y.create.l HWIO_APCS_GICD_CTLR_ADDR A:0xb000000
y.create.l HWIO_APCS_GICD_TYPER_ADDR A:0xb000004
y.create.l HWIO_APCS_GICD_IIDR_ADDR A:0xb000008
y.create.l HWIO_APCS_GICD_ANSACR_ADDR A:0xb000020
y.create.l HWIO_APCS_GICD_CGCR_ADDR A:0xb000024
y.create.l HWIO_APCS_GICD_HW_VERSION_ADDR A:0xb000030
y.create.l HWIO_APCS_GICD_ISR0_ADDR A:0xb000080
y.create.l HWIO_APCS_GICD_ISR1_ADDR A:0xb000084
y.create.l HWIO_APCS_GICD_ISR2_ADDR A:0xb000088
y.create.l HWIO_APCS_GICD_ISR3_ADDR A:0xb00008c
y.create.l HWIO_APCS_GICD_ISR4_ADDR A:0xb000090
y.create.l HWIO_APCS_GICD_ISR5_ADDR A:0xb000094
y.create.l HWIO_APCS_GICD_ISR6_ADDR A:0xb000098
y.create.l HWIO_APCS_GICD_ISR7_ADDR A:0xb00009c
y.create.l HWIO_APCS_GICD_ISR8_ADDR A:0xb0000a0
y.create.l HWIO_APCS_GICD_ISENABLER0_ADDR A:0xb000100
y.create.l HWIO_APCS_GICD_ISENABLER1_ADDR A:0xb000104
y.create.l HWIO_APCS_GICD_ISENABLER2_ADDR A:0xb000108
y.create.l HWIO_APCS_GICD_ISENABLER3_ADDR A:0xb00010c
y.create.l HWIO_APCS_GICD_ISENABLER4_ADDR A:0xb000110
y.create.l HWIO_APCS_GICD_ISENABLER5_ADDR A:0xb000114
y.create.l HWIO_APCS_GICD_ISENABLER6_ADDR A:0xb000118
y.create.l HWIO_APCS_GICD_ISENABLER7_ADDR A:0xb00011c
y.create.l HWIO_APCS_GICD_ISENABLER8_ADDR A:0xb000120
y.create.l HWIO_APCS_GICD_ICENABLER0_ADDR A:0xb000180
y.create.l HWIO_APCS_GICD_ICENABLER1_ADDR A:0xb000184
y.create.l HWIO_APCS_GICD_ICENABLER2_ADDR A:0xb000188
y.create.l HWIO_APCS_GICD_ICENABLER3_ADDR A:0xb00018c
y.create.l HWIO_APCS_GICD_ICENABLER4_ADDR A:0xb000190
y.create.l HWIO_APCS_GICD_ICENABLER5_ADDR A:0xb000194
y.create.l HWIO_APCS_GICD_ICENABLER6_ADDR A:0xb000198
y.create.l HWIO_APCS_GICD_ICENABLER7_ADDR A:0xb00019c
y.create.l HWIO_APCS_GICD_ICENABLER8_ADDR A:0xb0001a0
y.create.l HWIO_APCS_GICD_ISPENDR0_ADDR A:0xb000200
y.create.l HWIO_APCS_GICD_ISPENDR1_ADDR A:0xb000204
y.create.l HWIO_APCS_GICD_ISPENDR2_ADDR A:0xb000208
y.create.l HWIO_APCS_GICD_ISPENDR3_ADDR A:0xb00020c
y.create.l HWIO_APCS_GICD_ISPENDR4_ADDR A:0xb000210
y.create.l HWIO_APCS_GICD_ISPENDR5_ADDR A:0xb000214
y.create.l HWIO_APCS_GICD_ISPENDR6_ADDR A:0xb000218
y.create.l HWIO_APCS_GICD_ISPENDR7_ADDR A:0xb00021c
y.create.l HWIO_APCS_GICD_ISPENDR8_ADDR A:0xb000220
y.create.l HWIO_APCS_GICD_ICPENDR0_ADDR A:0xb000280
y.create.l HWIO_APCS_GICD_ICPENDR1_ADDR A:0xb000284
y.create.l HWIO_APCS_GICD_ICPENDR2_ADDR A:0xb000288
y.create.l HWIO_APCS_GICD_ICPENDR3_ADDR A:0xb00028c
y.create.l HWIO_APCS_GICD_ICPENDR4_ADDR A:0xb000290
y.create.l HWIO_APCS_GICD_ICPENDR5_ADDR A:0xb000294
y.create.l HWIO_APCS_GICD_ICPENDR6_ADDR A:0xb000298
y.create.l HWIO_APCS_GICD_ICPENDR7_ADDR A:0xb00029c
y.create.l HWIO_APCS_GICD_ICPENDR8_ADDR A:0xb0002a0
y.create.l HWIO_APCS_GICD_ISACTIVER0_ADDR A:0xb000300
y.create.l HWIO_APCS_GICD_ISACTIVER1_ADDR A:0xb000304
y.create.l HWIO_APCS_GICD_ISACTIVER2_ADDR A:0xb000308
y.create.l HWIO_APCS_GICD_ISACTIVER3_ADDR A:0xb00030c
y.create.l HWIO_APCS_GICD_ISACTIVER4_ADDR A:0xb000310
y.create.l HWIO_APCS_GICD_ISACTIVER5_ADDR A:0xb000314
y.create.l HWIO_APCS_GICD_ISACTIVER6_ADDR A:0xb000318
y.create.l HWIO_APCS_GICD_ISACTIVER7_ADDR A:0xb00031c
y.create.l HWIO_APCS_GICD_ISACTIVER8_ADDR A:0xb000320
y.create.l HWIO_APCS_GICD_ICACTIVER0_ADDR A:0xb000380
y.create.l HWIO_APCS_GICD_ICACTIVER1_ADDR A:0xb000384
y.create.l HWIO_APCS_GICD_ICACTIVER2_ADDR A:0xb000388
y.create.l HWIO_APCS_GICD_ICACTIVER3_ADDR A:0xb00038c
y.create.l HWIO_APCS_GICD_ICACTIVER4_ADDR A:0xb000390
y.create.l HWIO_APCS_GICD_ICACTIVER5_ADDR A:0xb000394
y.create.l HWIO_APCS_GICD_ICACTIVER6_ADDR A:0xb000398
y.create.l HWIO_APCS_GICD_ICACTIVER7_ADDR A:0xb00039c
y.create.l HWIO_APCS_GICD_ICACTIVER8_ADDR A:0xb0003a0
y.create.l HWIO_APCS_GICD_IPRIORITYR0_ADDR A:0xb000400
y.create.l HWIO_APCS_GICD_IPRIORITYR1_ADDR A:0xb000404
y.create.l HWIO_APCS_GICD_IPRIORITYR2_ADDR A:0xb000408
y.create.l HWIO_APCS_GICD_IPRIORITYR3_ADDR A:0xb00040c
y.create.l HWIO_APCS_GICD_IPRIORITYR4_ADDR A:0xb000410
y.create.l HWIO_APCS_GICD_IPRIORITYR5_ADDR A:0xb000414
y.create.l HWIO_APCS_GICD_IPRIORITYR6_ADDR A:0xb000418
y.create.l HWIO_APCS_GICD_IPRIORITYR7_ADDR A:0xb00041c
y.create.l HWIO_APCS_GICD_IPRIORITYR8_ADDR A:0xb000420
y.create.l HWIO_APCS_GICD_IPRIORITYR9_ADDR A:0xb000424
y.create.l HWIO_APCS_GICD_ITARGETSR0_ADDR A:0xb000800
y.create.l HWIO_APCS_GICD_ITARGETSR1_ADDR A:0xb000804
y.create.l HWIO_APCS_GICD_ITARGETSR2_ADDR A:0xb000808
y.create.l HWIO_APCS_GICD_ITARGETSR3_ADDR A:0xb00080c
y.create.l HWIO_APCS_GICD_ITARGETSR4_ADDR A:0xb000810
y.create.l HWIO_APCS_GICD_ITARGETSR5_ADDR A:0xb000814
y.create.l HWIO_APCS_GICD_ITARGETSR6_ADDR A:0xb000818
y.create.l HWIO_APCS_GICD_ITARGETSR7_ADDR A:0xb00081c
y.create.l HWIO_APCS_GICD_ITARGETSR8_ADDR A:0xb000820
y.create.l HWIO_APCS_GICD_ITARGETSR9_ADDR A:0xb000824
y.create.l HWIO_APCS_GICD_ICFGR0_ADDR A:0xb000c00
y.create.l HWIO_APCS_GICD_ICFGR1_ADDR A:0xb000c04
y.create.l HWIO_APCS_GICD_ICFGR2_ADDR A:0xb000c08
y.create.l HWIO_APCS_GICD_ICFGR3_ADDR A:0xb000c0c
y.create.l HWIO_APCS_GICD_ICFGR4_ADDR A:0xb000c10
y.create.l HWIO_APCS_GICD_ICFGR5_ADDR A:0xb000c14
y.create.l HWIO_APCS_GICD_ICFGR6_ADDR A:0xb000c18
y.create.l HWIO_APCS_GICD_ICFGR7_ADDR A:0xb000c1c
y.create.l HWIO_APCS_GICD_ICFGR8_ADDR A:0xb000c20
y.create.l HWIO_APCS_GICD_ICFGR9_ADDR A:0xb000c24
y.create.l HWIO_APCS_GICD_SGIR_ADDR A:0xb000f00
y.create.l HWIO_APCS_GICD_CPENDSGIR0_ADDR A:0xb000f10
y.create.l HWIO_APCS_GICD_CPENDSGIR1_ADDR A:0xb000f14
y.create.l HWIO_APCS_GICD_CPENDSGIR2_ADDR A:0xb000f18
y.create.l HWIO_APCS_GICD_CPENDSGIR3_ADDR A:0xb000f1c
y.create.l HWIO_APCS_GICD_SPENDSGIR0_ADDR A:0xb000f20
y.create.l HWIO_APCS_GICD_SPENDSGIR1_ADDR A:0xb000f24
y.create.l HWIO_APCS_GICD_SPENDSGIR2_ADDR A:0xb000f28
y.create.l HWIO_APCS_GICD_SPENDSGIR3_ADDR A:0xb000f2c
y.create.l HWIO_APCS_GICD_PIDR0_ADDR A:0xb000fd0
y.create.l HWIO_APCS_GICD_PIDR1_ADDR A:0xb000fd4
y.create.l HWIO_APCS_GICD_PIDR2_ADDR A:0xb000fd8
y.create.l HWIO_APCS_GICD_PIDR3_ADDR A:0xb000fdc
y.create.l HWIO_APCS_GICD_PIDR4_ADDR A:0xb000fe0
y.create.l HWIO_APCS_GICD_PIDR5_ADDR A:0xb000fe4
y.create.l HWIO_APCS_GICD_PIDR6_ADDR A:0xb000fe8
y.create.l HWIO_APCS_GICD_PIDR7_ADDR A:0xb000fec
y.create.l HWIO_APCS_GICD_CIDR0_ADDR A:0xb000ff0
y.create.l HWIO_APCS_GICD_CIDR1_ADDR A:0xb000ff4
y.create.l HWIO_APCS_GICD_CIDR2_ADDR A:0xb000ff8
y.create.l HWIO_APCS_GICD_CIDR3_ADDR A:0xb000ffc
y.create.l HWIO_APCS_GICH_HCR_ADDR A:0xb001000
y.create.l HWIO_APCS_GICH_VTR_ADDR A:0xb001004
y.create.l HWIO_APCS_GICH_VMCR_ADDR A:0xb001008
y.create.l HWIO_APCS_GICH_MISR_ADDR A:0xb001010
y.create.l HWIO_APCS_GICH_EISR_ADDR A:0xb001020
y.create.l HWIO_APCS_GICH_ELRSR_ADDR A:0xb001030
y.create.l HWIO_APCS_GICH_APR_ADDR A:0xb0010f0
y.create.l HWIO_APCS_GICH_LR0_ADDR A:0xb001100
y.create.l HWIO_APCS_GICH_LR1_ADDR A:0xb001104
y.create.l HWIO_APCS_GICH_LR2_ADDR A:0xb001108
y.create.l HWIO_APCS_GICH_LR3_ADDR A:0xb00110c
y.create.l HWIO_APCS_GICH_SW_LR_ADDR A:0xb001120
y.create.l HWIO_APCS_GICC_CTLR_ADDR A:0xb002000
y.create.l HWIO_APCS_GICC_PMR_ADDR A:0xb002004
y.create.l HWIO_APCS_GICC_BPR_ADDR A:0xb002008
y.create.l HWIO_APCS_GICC_IAR_ADDR A:0xb00200c
y.create.l HWIO_APCS_GICC_EOIR_ADDR A:0xb002010
y.create.l HWIO_APCS_GICC_RPR_ADDR A:0xb002014
y.create.l HWIO_APCS_GICC_HPPIR_ADDR A:0xb002018
y.create.l HWIO_APCS_GICC_ABPR_ADDR A:0xb00201c
y.create.l HWIO_APCS_GICC_AIAR_ADDR A:0xb002020
y.create.l HWIO_APCS_GICC_AEOIR_ADDR A:0xb002024
y.create.l HWIO_APCS_GICC_AHPPIR_ADDR A:0xb002028
y.create.l HWIO_APCS_GICC_APR_ADDR A:0xb0020d0
y.create.l HWIO_APCS_GICC_NSAPR_ADDR A:0xb0020e0
y.create.l HWIO_APCS_GICC_IIDR_ADDR A:0xb0020fc
y.create.l HWIO_APCS_GICC_DIR_ADDR A:0xb003000
y.create.l HWIO_APCS_GICV_CTLR_ADDR A:0xb004000
y.create.l HWIO_APCS_GICV_PMR_ADDR A:0xb004004
y.create.l HWIO_APCS_GICV_BPR_ADDR A:0xb004008
y.create.l HWIO_APCS_GICV_IAR_ADDR A:0xb00400c
y.create.l HWIO_APCS_GICV_EOIR_ADDR A:0xb004010
y.create.l HWIO_APCS_GICV_RPR_ADDR A:0xb004014
y.create.l HWIO_APCS_GICV_HPPIR_ADDR A:0xb004018
y.create.l HWIO_APCS_GICV_ABPR_ADDR A:0xb00401c
y.create.l HWIO_APCS_GICV_AIAR_ADDR A:0xb004020
y.create.l HWIO_APCS_GICV_AEOIR_ADDR A:0xb004024
y.create.l HWIO_APCS_GICV_AHPPIR_ADDR A:0xb004028
y.create.l HWIO_APCS_GICV_APR_ADDR A:0xb0040d0
y.create.l HWIO_APCS_GICV_IIDR_ADDR A:0xb0040fc
y.create.l HWIO_APCS_GICV_DIR_ADDR A:0xb005000
y.create.l HWIO_APCS_ACCSECURE_ADDR A:0xb008000
y.create.l HWIO_APCS_CPU_PWR_CTL_ADDR A:0xb008004
y.create.l HWIO_APCS_ACC_STS_ADDR A:0xb008008
y.create.l HWIO_APCS_ATSTBUS_SEL_ADDR A:0xb00800c
y.create.l HWIO_APCS_CPU_TRGTD_DBG_RST_ADDR A:0xb008010
y.create.l HWIO_APCS_CPU_AUX_CLK_SEL_ADDR A:0xb008014
y.create.l HWIO_APCS_CPU_PLL_MODE_ADDR A:0xb008018
y.create.l HWIO_APCS_CPU_PLL_L_VAL_ADDR A:0xb00801c
y.create.l HWIO_APCS_CPU_PLL_ALPHA_VAL_ADDR A:0xb008020
y.create.l HWIO_APCS_CPU_PLL_ALPHA_VAL_U_ADDR A:0xb008024
y.create.l HWIO_APCS_CPU_PLL_USER_CTL_ADDR A:0xb008028
y.create.l HWIO_APCS_CPU_PLL_USER_CTL_U_ADDR A:0xb00802c
y.create.l HWIO_APCS_CPU_PLL_CONFIG_CTL_ADDR A:0xb008030
y.create.l HWIO_APCS_CPU_PLL_TEST_CTL_ADDR A:0xb008034
y.create.l HWIO_APCS_CPU_PLL_TEST_CTL_U_ADDR A:0xb008038
y.create.l HWIO_APCS_CPU_PLL_STATUS_ADDR A:0xb00803c
y.create.l HWIO_APCS_CPU_PLL_FREQ_CTL_ADDR A:0xb008040
y.create.l HWIO_APCS_TZIPC_INTERRUPT_ADDR A:0xb008044
y.create.l HWIO_APCS_A7_CFG_ADDR A:0xb008048
y.create.l HWIO_GCC_DBG_CLK_ON_REQ_ADDR A:0xb00804c
y.create.l HWIO_APCS_SAW2_SECURE_ADDR A:0xb009000
y.create.l HWIO_APCS_SAW2_ID_ADDR A:0xb009004
y.create.l HWIO_APCS_SAW2_CFG_ADDR A:0xb009008
y.create.l HWIO_APCS_SAW2_SPM_STS_ADDR A:0xb00900c
y.create.l HWIO_APCS_SAW2_AVS_STS_ADDR A:0xb009010
y.create.l HWIO_APCS_SAW2_PMIC_STS_ADDR A:0xb009014
y.create.l HWIO_APCS_SAW2_RST_ADDR A:0xb009018
y.create.l HWIO_APCS_SAW2_SPM_CTL_ADDR A:0xb009030
y.create.l HWIO_APCS_SAW2_SPM_DLY_ADDR A:0xb009034
y.create.l HWIO_APCS_SAW2_SPM_STS2_ADDR A:0xb009038
y.create.l HWIO_APCS_SAW2_SPM_SLP_SEQ_ENTRY_0_ADDR A:0xb009400
y.create.l HWIO_APCS_SAW2_SPM_SLP_SEQ_ENTRY_1_ADDR A:0xb009404
y.create.l HWIO_APCS_SAW2_SPM_SLP_SEQ_ENTRY_2_ADDR A:0xb009408
y.create.l HWIO_APCS_SAW2_SPM_SLP_SEQ_ENTRY_3_ADDR A:0xb00940c
y.create.l HWIO_APCS_SAW2_SPM_SLP_SEQ_ENTRY_4_ADDR A:0xb009410
y.create.l HWIO_APCS_SAW2_SPM_SLP_SEQ_ENTRY_5_ADDR A:0xb009414
y.create.l HWIO_APCS_SAW2_SPM_SLP_SEQ_ENTRY_6_ADDR A:0xb009418
y.create.l HWIO_APCS_SAW2_SPM_SLP_SEQ_ENTRY_7_ADDR A:0xb00941c
y.create.l HWIO_APCS_SAW2_SPM_SLP_SEQ_ENTRY_8_ADDR A:0xb009420
y.create.l HWIO_APCS_SAW2_SPM_SLP_SEQ_ENTRY_9_ADDR A:0xb009424
y.create.l HWIO_APCS_SAW2_SPM_PMIC_DATA_0_ADDR A:0xb009040
y.create.l HWIO_APCS_SAW2_SPM_PMIC_DATA_1_ADDR A:0xb009044
y.create.l HWIO_APCS_SAW2_VERSION_ADDR A:0xb009fd0
y.create.l HWIO_QTMR_AC_CNTFRQ_ADDR A:0xb020000
y.create.l HWIO_QTMR_AC_CNTSR_ADDR A:0xb020004
y.create.l HWIO_QTMR_AC_CNTTID_ADDR A:0xb020008
y.create.l HWIO_QTMR_AC_CNTACR_0_ADDR A:0xb020040
y.create.l HWIO_QTMR_AC_CNTACR_1_ADDR A:0xb020044
y.create.l HWIO_QTMR_AC_CNTACR_2_ADDR A:0xb020048
y.create.l HWIO_QTMR_AC_CNTACR_3_ADDR A:0xb02004c
y.create.l HWIO_QTMR_AC_CNTACR_4_ADDR A:0xb020050
y.create.l HWIO_QTMR_AC_CNTACR_5_ADDR A:0xb020054
y.create.l HWIO_QTMR_AC_CNTACR_6_ADDR A:0xb020058
y.create.l HWIO_QTMR_AC_CNTACR_7_ADDR A:0xb02005c
y.create.l HWIO_QTMR_AC_CNTVOFF_LO_0_ADDR A:0xb020080
y.create.l HWIO_QTMR_AC_CNTVOFF_LO_1_ADDR A:0xb020088
y.create.l HWIO_QTMR_AC_CNTVOFF_LO_2_ADDR A:0xb020090
y.create.l HWIO_QTMR_AC_CNTVOFF_LO_3_ADDR A:0xb020098
y.create.l HWIO_QTMR_AC_CNTVOFF_LO_4_ADDR A:0xb0200a0
y.create.l HWIO_QTMR_AC_CNTVOFF_LO_5_ADDR A:0xb0200a8
y.create.l HWIO_QTMR_AC_CNTVOFF_LO_6_ADDR A:0xb0200b0
y.create.l HWIO_QTMR_AC_CNTVOFF_LO_7_ADDR A:0xb0200b8
y.create.l HWIO_QTMR_AC_CNTVOFF_HI_0_ADDR A:0xb020084
y.create.l HWIO_QTMR_AC_CNTVOFF_HI_1_ADDR A:0xb02008c
y.create.l HWIO_QTMR_AC_CNTVOFF_HI_2_ADDR A:0xb020094
y.create.l HWIO_QTMR_AC_CNTVOFF_HI_3_ADDR A:0xb02009c
y.create.l HWIO_QTMR_AC_CNTVOFF_HI_4_ADDR A:0xb0200a4
y.create.l HWIO_QTMR_AC_CNTVOFF_HI_5_ADDR A:0xb0200ac
y.create.l HWIO_QTMR_AC_CNTVOFF_HI_6_ADDR A:0xb0200b4
y.create.l HWIO_QTMR_AC_CNTVOFF_HI_7_ADDR A:0xb0200bc
y.create.l HWIO_QTMR_AC_CFG_ADDR A:0xb020fc0
y.create.l HWIO_QTMR_AC_VERSION_ADDR A:0xb020fd0
y.create.l HWIO_APCS_F0_QTMR_V1_CNTPCT_LO_ADDR A:0xb021000
y.create.l HWIO_APCS_F0_QTMR_V1_CNTPCT_HI_ADDR A:0xb021004
y.create.l HWIO_APCS_F0_QTMR_V1_CNTVCT_LO_ADDR A:0xb021008
y.create.l HWIO_APCS_F0_QTMR_V1_CNTVCT_HI_ADDR A:0xb02100c
y.create.l HWIO_APCS_F0_QTMR_V1_CNTFRQ_ADDR A:0xb021010
y.create.l HWIO_APCS_F0_QTMR_V1_CNTPL0ACR_ADDR A:0xb021014
y.create.l HWIO_APCS_F0_QTMR_V1_CNTVOFF_LO_ADDR A:0xb021018
y.create.l HWIO_APCS_F0_QTMR_V1_CNTVOFF_HI_ADDR A:0xb02101c
y.create.l HWIO_APCS_F0_QTMR_V1_CNTP_CVAL_LO_ADDR A:0xb021020
y.create.l HWIO_APCS_F0_QTMR_V1_CNTP_CVAL_HI_ADDR A:0xb021024
y.create.l HWIO_APCS_F0_QTMR_V1_CNTP_TVAL_ADDR A:0xb021028
y.create.l HWIO_APCS_F0_QTMR_V1_CNTP_CTL_ADDR A:0xb02102c
y.create.l HWIO_APCS_F0_QTMR_V1_CNTV_CVAL_LO_ADDR A:0xb021030
y.create.l HWIO_APCS_F0_QTMR_V1_CNTV_CVAL_HI_ADDR A:0xb021034
y.create.l HWIO_APCS_F0_QTMR_V1_CNTV_TVAL_ADDR A:0xb021038
y.create.l HWIO_APCS_F0_QTMR_V1_CNTV_CTL_ADDR A:0xb02103c
y.create.l HWIO_APCS_F0_QTMR_V1_VERSION_ADDR A:0xb021fd0
y.create.l HWIO_APCS_F0_QTMR_V2_CNTPCT_LO_ADDR A:0xb022000
y.create.l HWIO_APCS_F0_QTMR_V2_CNTPCT_HI_ADDR A:0xb022004
y.create.l HWIO_APCS_F0_QTMR_V2_CNTVCT_LO_ADDR A:0xb022008
y.create.l HWIO_APCS_F0_QTMR_V2_CNTVCT_HI_ADDR A:0xb02200c
y.create.l HWIO_APCS_F0_QTMR_V2_CNTFRQ_ADDR A:0xb022010
y.create.l HWIO_APCS_F0_QTMR_V2_CNTP_CVAL_LO_ADDR A:0xb022020
y.create.l HWIO_APCS_F0_QTMR_V2_CNTP_CVAL_HI_ADDR A:0xb022024
y.create.l HWIO_APCS_F0_QTMR_V2_CNTP_TVAL_ADDR A:0xb022028
y.create.l HWIO_APCS_F0_QTMR_V2_CNTP_CTL_ADDR A:0xb02202c
y.create.l HWIO_APCS_F0_QTMR_V2_CNTV_CVAL_LO_ADDR A:0xb022030
y.create.l HWIO_APCS_F0_QTMR_V2_CNTV_CVAL_HI_ADDR A:0xb022034
y.create.l HWIO_APCS_F0_QTMR_V2_CNTV_TVAL_ADDR A:0xb022038
y.create.l HWIO_APCS_F0_QTMR_V2_CNTV_CTL_ADDR A:0xb02203c
y.create.l HWIO_APCS_F0_QTMR_V2_VERSION_ADDR A:0xb022fd0
y.create.l HWIO_APCS_F1_QTMR_V1_CNTPCT_LO_ADDR A:0xb023000
y.create.l HWIO_APCS_F1_QTMR_V1_CNTPCT_HI_ADDR A:0xb023004
y.create.l HWIO_APCS_F1_QTMR_V1_CNTVCT_LO_ADDR A:0xb023008
y.create.l HWIO_APCS_F1_QTMR_V1_CNTVCT_HI_ADDR A:0xb02300c
y.create.l HWIO_APCS_F1_QTMR_V1_CNTFRQ_ADDR A:0xb023010
y.create.l HWIO_APCS_F1_QTMR_V1_CNTPL0ACR_ADDR A:0xb023014
y.create.l HWIO_APCS_F1_QTMR_V1_CNTVOFF_LO_ADDR A:0xb023018
y.create.l HWIO_APCS_F1_QTMR_V1_CNTVOFF_HI_ADDR A:0xb02301c
y.create.l HWIO_APCS_F1_QTMR_V1_CNTP_CVAL_LO_ADDR A:0xb023020
y.create.l HWIO_APCS_F1_QTMR_V1_CNTP_CVAL_HI_ADDR A:0xb023024
y.create.l HWIO_APCS_F1_QTMR_V1_CNTP_TVAL_ADDR A:0xb023028
y.create.l HWIO_APCS_F1_QTMR_V1_CNTP_CTL_ADDR A:0xb02302c
y.create.l HWIO_APCS_F1_QTMR_V1_CNTV_CVAL_LO_ADDR A:0xb023030
y.create.l HWIO_APCS_F1_QTMR_V1_CNTV_CVAL_HI_ADDR A:0xb023034
y.create.l HWIO_APCS_F1_QTMR_V1_CNTV_TVAL_ADDR A:0xb023038
y.create.l HWIO_APCS_F1_QTMR_V1_CNTV_CTL_ADDR A:0xb02303c
y.create.l HWIO_APCS_F1_QTMR_V1_VERSION_ADDR A:0xb023fd0
y.create.l HWIO_APCS_F2_QTMR_V1_CNTPCT_LO_ADDR A:0xb024000
y.create.l HWIO_APCS_F2_QTMR_V1_CNTPCT_HI_ADDR A:0xb024004
y.create.l HWIO_APCS_F2_QTMR_V1_CNTVCT_LO_ADDR A:0xb024008
y.create.l HWIO_APCS_F2_QTMR_V1_CNTVCT_HI_ADDR A:0xb02400c
y.create.l HWIO_APCS_F2_QTMR_V1_CNTFRQ_ADDR A:0xb024010
y.create.l HWIO_APCS_F2_QTMR_V1_CNTPL0ACR_ADDR A:0xb024014
y.create.l HWIO_APCS_F2_QTMR_V1_CNTVOFF_LO_ADDR A:0xb024018
y.create.l HWIO_APCS_F2_QTMR_V1_CNTVOFF_HI_ADDR A:0xb02401c
y.create.l HWIO_APCS_F2_QTMR_V1_CNTP_CVAL_LO_ADDR A:0xb024020
y.create.l HWIO_APCS_F2_QTMR_V1_CNTP_CVAL_HI_ADDR A:0xb024024
y.create.l HWIO_APCS_F2_QTMR_V1_CNTP_TVAL_ADDR A:0xb024028
y.create.l HWIO_APCS_F2_QTMR_V1_CNTP_CTL_ADDR A:0xb02402c
y.create.l HWIO_APCS_F2_QTMR_V1_CNTV_CVAL_LO_ADDR A:0xb024030
y.create.l HWIO_APCS_F2_QTMR_V1_CNTV_CVAL_HI_ADDR A:0xb024034
y.create.l HWIO_APCS_F2_QTMR_V1_CNTV_TVAL_ADDR A:0xb024038
y.create.l HWIO_APCS_F2_QTMR_V1_CNTV_CTL_ADDR A:0xb02403c
y.create.l HWIO_APCS_F2_QTMR_V1_VERSION_ADDR A:0xb024fd0
y.create.l HWIO_APCS_F3_QTMR_V1_CNTPCT_LO_ADDR A:0xb025000
y.create.l HWIO_APCS_F3_QTMR_V1_CNTPCT_HI_ADDR A:0xb025004
y.create.l HWIO_APCS_F3_QTMR_V1_CNTVCT_LO_ADDR A:0xb025008
y.create.l HWIO_APCS_F3_QTMR_V1_CNTVCT_HI_ADDR A:0xb02500c
y.create.l HWIO_APCS_F3_QTMR_V1_CNTFRQ_ADDR A:0xb025010
y.create.l HWIO_APCS_F3_QTMR_V1_CNTPL0ACR_ADDR A:0xb025014
y.create.l HWIO_APCS_F3_QTMR_V1_CNTVOFF_LO_ADDR A:0xb025018
y.create.l HWIO_APCS_F3_QTMR_V1_CNTVOFF_HI_ADDR A:0xb02501c
y.create.l HWIO_APCS_F3_QTMR_V1_CNTP_CVAL_LO_ADDR A:0xb025020
y.create.l HWIO_APCS_F3_QTMR_V1_CNTP_CVAL_HI_ADDR A:0xb025024
y.create.l HWIO_APCS_F3_QTMR_V1_CNTP_TVAL_ADDR A:0xb025028
y.create.l HWIO_APCS_F3_QTMR_V1_CNTP_CTL_ADDR A:0xb02502c
y.create.l HWIO_APCS_F3_QTMR_V1_CNTV_CVAL_LO_ADDR A:0xb025030
y.create.l HWIO_APCS_F3_QTMR_V1_CNTV_CVAL_HI_ADDR A:0xb025034
y.create.l HWIO_APCS_F3_QTMR_V1_CNTV_TVAL_ADDR A:0xb025038
y.create.l HWIO_APCS_F3_QTMR_V1_CNTV_CTL_ADDR A:0xb02503c
y.create.l HWIO_APCS_F3_QTMR_V1_VERSION_ADDR A:0xb025fd0
y.create.l HWIO_APCS_F4_QTMR_V1_CNTPCT_LO_ADDR A:0xb026000
y.create.l HWIO_APCS_F4_QTMR_V1_CNTPCT_HI_ADDR A:0xb026004
y.create.l HWIO_APCS_F4_QTMR_V1_CNTVCT_LO_ADDR A:0xb026008
y.create.l HWIO_APCS_F4_QTMR_V1_CNTVCT_HI_ADDR A:0xb02600c
y.create.l HWIO_APCS_F4_QTMR_V1_CNTFRQ_ADDR A:0xb026010
y.create.l HWIO_APCS_F4_QTMR_V1_CNTPL0ACR_ADDR A:0xb026014
y.create.l HWIO_APCS_F4_QTMR_V1_CNTVOFF_LO_ADDR A:0xb026018
y.create.l HWIO_APCS_F4_QTMR_V1_CNTVOFF_HI_ADDR A:0xb02601c
y.create.l HWIO_APCS_F4_QTMR_V1_CNTP_CVAL_LO_ADDR A:0xb026020
y.create.l HWIO_APCS_F4_QTMR_V1_CNTP_CVAL_HI_ADDR A:0xb026024
y.create.l HWIO_APCS_F4_QTMR_V1_CNTP_TVAL_ADDR A:0xb026028
y.create.l HWIO_APCS_F4_QTMR_V1_CNTP_CTL_ADDR A:0xb02602c
y.create.l HWIO_APCS_F4_QTMR_V1_CNTV_CVAL_LO_ADDR A:0xb026030
y.create.l HWIO_APCS_F4_QTMR_V1_CNTV_CVAL_HI_ADDR A:0xb026034
y.create.l HWIO_APCS_F4_QTMR_V1_CNTV_TVAL_ADDR A:0xb026038
y.create.l HWIO_APCS_F4_QTMR_V1_CNTV_CTL_ADDR A:0xb02603c
y.create.l HWIO_APCS_F4_QTMR_V1_VERSION_ADDR A:0xb026fd0
y.create.l HWIO_APCS_F5_QTMR_V1_CNTPCT_LO_ADDR A:0xb027000
y.create.l HWIO_APCS_F5_QTMR_V1_CNTPCT_HI_ADDR A:0xb027004
y.create.l HWIO_APCS_F5_QTMR_V1_CNTVCT_LO_ADDR A:0xb027008
y.create.l HWIO_APCS_F5_QTMR_V1_CNTVCT_HI_ADDR A:0xb02700c
y.create.l HWIO_APCS_F5_QTMR_V1_CNTFRQ_ADDR A:0xb027010
y.create.l HWIO_APCS_F5_QTMR_V1_CNTPL0ACR_ADDR A:0xb027014
y.create.l HWIO_APCS_F5_QTMR_V1_CNTVOFF_LO_ADDR A:0xb027018
y.create.l HWIO_APCS_F5_QTMR_V1_CNTVOFF_HI_ADDR A:0xb02701c
y.create.l HWIO_APCS_F5_QTMR_V1_CNTP_CVAL_LO_ADDR A:0xb027020
y.create.l HWIO_APCS_F5_QTMR_V1_CNTP_CVAL_HI_ADDR A:0xb027024
y.create.l HWIO_APCS_F5_QTMR_V1_CNTP_TVAL_ADDR A:0xb027028
y.create.l HWIO_APCS_F5_QTMR_V1_CNTP_CTL_ADDR A:0xb02702c
y.create.l HWIO_APCS_F5_QTMR_V1_CNTV_CVAL_LO_ADDR A:0xb027030
y.create.l HWIO_APCS_F5_QTMR_V1_CNTV_CVAL_HI_ADDR A:0xb027034
y.create.l HWIO_APCS_F5_QTMR_V1_CNTV_TVAL_ADDR A:0xb027038
y.create.l HWIO_APCS_F5_QTMR_V1_CNTV_CTL_ADDR A:0xb02703c
y.create.l HWIO_APCS_F5_QTMR_V1_VERSION_ADDR A:0xb027fd0
y.create.l HWIO_APCS_F6_QTMR_V1_CNTPCT_LO_ADDR A:0xb028000
y.create.l HWIO_APCS_F6_QTMR_V1_CNTPCT_HI_ADDR A:0xb028004
y.create.l HWIO_APCS_F6_QTMR_V1_CNTVCT_LO_ADDR A:0xb028008
y.create.l HWIO_APCS_F6_QTMR_V1_CNTVCT_HI_ADDR A:0xb02800c
y.create.l HWIO_APCS_F6_QTMR_V1_CNTFRQ_ADDR A:0xb028010
y.create.l HWIO_APCS_F6_QTMR_V1_CNTPL0ACR_ADDR A:0xb028014
y.create.l HWIO_APCS_F6_QTMR_V1_CNTVOFF_LO_ADDR A:0xb028018
y.create.l HWIO_APCS_F6_QTMR_V1_CNTVOFF_HI_ADDR A:0xb02801c
y.create.l HWIO_APCS_F6_QTMR_V1_CNTP_CVAL_LO_ADDR A:0xb028020
y.create.l HWIO_APCS_F6_QTMR_V1_CNTP_CVAL_HI_ADDR A:0xb028024
y.create.l HWIO_APCS_F6_QTMR_V1_CNTP_TVAL_ADDR A:0xb028028
y.create.l HWIO_APCS_F6_QTMR_V1_CNTP_CTL_ADDR A:0xb02802c
y.create.l HWIO_APCS_F6_QTMR_V1_CNTV_CVAL_LO_ADDR A:0xb028030
y.create.l HWIO_APCS_F6_QTMR_V1_CNTV_CVAL_HI_ADDR A:0xb028034
y.create.l HWIO_APCS_F6_QTMR_V1_CNTV_TVAL_ADDR A:0xb028038
y.create.l HWIO_APCS_F6_QTMR_V1_CNTV_CTL_ADDR A:0xb02803c
y.create.l HWIO_APCS_F6_QTMR_V1_VERSION_ADDR A:0xb028fd0
y.create.l HWIO_APCS_F7_QTMR_V1_CNTPCT_LO_ADDR A:0xb029000
y.create.l HWIO_APCS_F7_QTMR_V1_CNTPCT_HI_ADDR A:0xb029004
y.create.l HWIO_APCS_F7_QTMR_V1_CNTVCT_LO_ADDR A:0xb029008
y.create.l HWIO_APCS_F7_QTMR_V1_CNTVCT_HI_ADDR A:0xb02900c
y.create.l HWIO_APCS_F7_QTMR_V1_CNTFRQ_ADDR A:0xb029010
y.create.l HWIO_APCS_F7_QTMR_V1_CNTPL0ACR_ADDR A:0xb029014
y.create.l HWIO_APCS_F7_QTMR_V1_CNTVOFF_LO_ADDR A:0xb029018
y.create.l HWIO_APCS_F7_QTMR_V1_CNTVOFF_HI_ADDR A:0xb02901c
y.create.l HWIO_APCS_F7_QTMR_V1_CNTP_CVAL_LO_ADDR A:0xb029020
y.create.l HWIO_APCS_F7_QTMR_V1_CNTP_CVAL_HI_ADDR A:0xb029024
y.create.l HWIO_APCS_F7_QTMR_V1_CNTP_TVAL_ADDR A:0xb029028
y.create.l HWIO_APCS_F7_QTMR_V1_CNTP_CTL_ADDR A:0xb02902c
y.create.l HWIO_APCS_F7_QTMR_V1_CNTV_CVAL_LO_ADDR A:0xb029030
y.create.l HWIO_APCS_F7_QTMR_V1_CNTV_CVAL_HI_ADDR A:0xb029034
y.create.l HWIO_APCS_F7_QTMR_V1_CNTV_TVAL_ADDR A:0xb029038
y.create.l HWIO_APCS_F7_QTMR_V1_CNTV_CTL_ADDR A:0xb02903c
y.create.l HWIO_APCS_F7_QTMR_V1_VERSION_ADDR A:0xb029fd0
y.create.l HWIO_WDOG_SECURE_ADDR A:0xb017000
y.create.l HWIO_WDOG_RESET_ADDR A:0xb017004
y.create.l HWIO_WDOG_CTL_ADDR A:0xb017008
y.create.l HWIO_WDOG_STATUS_ADDR A:0xb01700c
y.create.l HWIO_WDOG_BARK_TIME_ADDR A:0xb017010
y.create.l HWIO_WDOG_BITE_TIME_ADDR A:0xb017014
y.create.l HWIO_WDOG_TEST_LOAD_STATUS_ADDR A:0xb017018
y.create.l HWIO_WDOG_TEST_LOAD_ADDR A:0xb01701c
y.create.l HWIO_WDOG_TEST_ADDR A:0xb017020
y.create.l HWIO_APCS_GLBSECURE_ADDR A:0xb010000
y.create.l HWIO_APCS_START_ADDR_ADDR A:0xb010004
y.create.l HWIO_APCS_CMD_RCGR_ADDR A:0xb010008
y.create.l HWIO_APCS_CFG_RCGR_ADDR A:0xb01000c
y.create.l HWIO_APCS_CBCR_ADDR A:0xb010010
y.create.l HWIO_APCS_GLB_CFG_ADDR A:0xb010014
y.create.l HWIO_APCS_GLB_BOOT_REMAP_ADDR A:0xb010018
y.create.l HWIO_APCS_GLB_TEST_BUSSEL_ADDR A:0xb01001c
y.create.l HWIO_APCS_GLB_EN_PWR_ST_ADDR A:0xb010020
y.create.l HWIO_APCS_GLB_QSB_LP_ADDR A:0xb010024
y.create.l HWIO_APCS_GLB_AHB_CLKON_ADDR A:0xb010028
y.create.l HWIO_APCS_GLB_QGIC_CFG_ADDR A:0xb01002c
y.create.l HWIO_APCS_GLB_GHDS_CNTR_ADDR A:0xb010030
y.create.l HWIO_APCS_TCM_REDIRECT_ADDR_ADDR A:0xb010034
y.create.l HWIO_APCS_A7_GLB_CFG_ADDR A:0xb010038
y.create.l HWIO_SPM_VOTE_TZ_ADDR A:0xb01003c
y.create.l HWIO_SPM_VOTE_HLOS_ADDR A:0xb010040
y.create.l HWIO_SPM_VOTE_HYP_ADDR A:0xb010044
y.create.l HWIO_SPM_VOTE_INT_STS_ADDR A:0xb010048
y.create.l HWIO_SPM_VOTE_INT_CLR_ADDR A:0xb01004c
y.create.l HWIO_APPS_BOOTFSM_CTL_ADDR A:0xb010050
y.create.l HWIO_APPS_BOOTFSM_STATUS_ADDR A:0xb010054
y.create.l HWIO_RBCPR_CLK_SEL_ADDR A:0xb010058
y.create.l HWIO_RBCPR_BCR_ADDR A:0xb01005c
y.create.l HWIO_RBCPR_PMIC_ADDR A:0xb010060
y.create.l HWIO_APCS_GCCSECURE_ADDR A:0xb011000
y.create.l HWIO_APCS_IPC_SECURITY_ADDR A:0xb011004
y.create.l HWIO_APCS_IPC_ADDR A:0xb011008
y.create.l HWIO_APCS_PWR_CTL_OVERRIDE_ADDR A:0xb01100c
y.create.l HWIO_APCS_GCLK_STS_ADDR A:0xb011010
y.create.l HWIO_APCS_L2_PWR_CTL_ADDR A:0xb011014
y.create.l HWIO_APCS_PWR_STS_ADDR A:0xb011018
y.create.l HWIO_APCS_CLK_DIAG_ADDR A:0xb01101c
y.create.l HWIO_APCS_ALL_TSTBUS_SEL_ADDR A:0xb011020
y.create.l HWIO_APCS_DBG_PWR_CTL_ADDR A:0xb011024
y.create.l HWIO_APCS_L2_AUX_CLK_SEL_ADDR A:0xb011028
y.create.l HWIO_APCS_SPARE_ADDR A:0xb01102c
y.create.l HWIO_APCS_SPARE_STS_ADDR A:0xb011030
y.create.l HWIO_XPU_STATUS_ADDR A:0xb011034
y.create.l HWIO_APCS_HW_EVENT_SEL_0_ADDR A:0xb011038
y.create.l HWIO_APCS_HW_EVENT_SEL_1_ADDR A:0xb01103c
y.create.l HWIO_APCS_HW_EVENT_SEL_2_ADDR A:0xb011040
y.create.l HWIO_APCS_HW_EVENT_SEL_3_ADDR A:0xb011044
y.create.l HWIO_APCS_HW_EVENT_SEL_4_ADDR A:0xb011048
y.create.l HWIO_APCS_HW_EVENT_SEL_5_ADDR A:0xb01104c
y.create.l HWIO_APCS_HW_EVENT_SEL_6_ADDR A:0xb011050
y.create.l HWIO_APCS_HW_EVENT_SEL_7_ADDR A:0xb011054
y.create.l HWIO_APCS_HW_EVENT_SEL_8_ADDR A:0xb011058
y.create.l HWIO_APCS_HW_EVENT_SEL_9_ADDR A:0xb01105c
y.create.l HWIO_APCS_RBCPR_VERSION_ADDR A:0xb018000
y.create.l HWIO_APCS_RBCPR_SENSOR_MASK0_ADDR A:0xb018020
y.create.l HWIO_APCS_RBCPR_SENSOR_MASK1_ADDR A:0xb018024
y.create.l HWIO_APCS_RBCPR_SENSOR_MASK2_ADDR A:0xb018028
y.create.l HWIO_APCS_RBCPR_SENSOR_MASK3_ADDR A:0xb01802c
y.create.l HWIO_APCS_RBCPR_SENSOR_BYPASS0_ADDR A:0xb018030
y.create.l HWIO_APCS_RBCPR_SENSOR_BYPASS1_ADDR A:0xb018034
y.create.l HWIO_APCS_RBCPR_SENSOR_BYPASS2_ADDR A:0xb018038
y.create.l HWIO_APCS_RBCPR_SENSOR_BYPASS3_ADDR A:0xb01803c
y.create.l HWIO_APCS_RBIF_PMIC_ADDR_ADDR A:0xb018040
y.create.l HWIO_APCS_RBCPR_TIMER_INTERVAL_ADDR A:0xb018044
y.create.l HWIO_APCS_RBIF_LIMIT_ADDR A:0xb018048
y.create.l HWIO_APCS_RBIF_TIMER_ADJUST_ADDR A:0xb01804c
y.create.l HWIO_APCS_RBCPR_GCNT_TARGET0_ADDR A:0xb018060
y.create.l HWIO_APCS_RBCPR_GCNT_TARGET1_ADDR A:0xb018064
y.create.l HWIO_APCS_RBCPR_GCNT_TARGET2_ADDR A:0xb018068
y.create.l HWIO_APCS_RBCPR_GCNT_TARGET3_ADDR A:0xb01806c
y.create.l HWIO_APCS_RBCPR_GCNT_TARGET4_ADDR A:0xb018070
y.create.l HWIO_APCS_RBCPR_GCNT_TARGET5_ADDR A:0xb018074
y.create.l HWIO_APCS_RBCPR_GCNT_TARGET6_ADDR A:0xb018078
y.create.l HWIO_APCS_RBCPR_GCNT_TARGET7_ADDR A:0xb01807c
y.create.l HWIO_APCS_RBCPR_STEP_QUOT_ADDR A:0xb018080
y.create.l HWIO_APCS_RBCPR_CTL_ADDR A:0xb018090
y.create.l HWIO_APCS_RBIF_SW_VLEVEL_ADDR A:0xb018094
y.create.l HWIO_APCS_RBIF_CONT_ACK_CMD_ADDR A:0xb018098
y.create.l HWIO_APCS_RBIF_CONT_NACK_CMD_ADDR A:0xb01809c
y.create.l HWIO_APCS_RBCPR_RESULT_0_ADDR A:0xb0180a0
y.create.l HWIO_APCS_RBCPR_RESULT_1_ADDR A:0xb0180a4
y.create.l HWIO_APCS_RBIF_IRQ_EN_0_ADDR A:0xb018100
y.create.l HWIO_APCS_RBIF_IRQ_EN_1_ADDR A:0xb018104
y.create.l HWIO_APCS_RBIF_IRQ_EN_2_ADDR A:0xb018108
y.create.l HWIO_APCS_RBIF_IRQ_CLEAR_ADDR A:0xb018110
y.create.l HWIO_APCS_RBIF_IRQ_STATUS_ADDR A:0xb018114
y.create.l HWIO_APCS_RBCPR_QUOT_AVG_ADDR A:0xb018118
y.create.l HWIO_APCS_RBCPR_DEBUG0_ADDR A:0xb01811c
y.create.l HWIO_APCS_RBCPR_DEBUG1_ADDR A:0xb018120
y.create.l HWIO_APCS_RBCPR_DEBUG2_ADDR A:0xb018124
y.create.l HWIO_APCS_RBCPR_BIST_MINMAX_ADDR A:0xb018128
y.create.l HWIO_APCS_RBCPR_BIST_RESULT_ADDR A:0xb01812c
y.create.l HWIO_APCS_RBCPR_BIST_FAIL_MAP0_ADDR A:0xb018130
y.create.l HWIO_APCS_RBCPR_BIST_FAIL_MAP1_ADDR A:0xb018134
y.create.l HWIO_APCS_RBCPR_BIST_FAIL_MAP2_ADDR A:0xb018138
y.create.l HWIO_APCS_RBCPR_BIST_FAIL_MAP3_ADDR A:0xb01813c
y.create.l HWIO_APCS_RBCPR_LOG_0_ADDR A:0xb018140
y.create.l HWIO_APCS_RBCPR_LOG_1_ADDR A:0xb018144
y.create.l HWIO_APCS_RBCPR_LOG_2_ADDR A:0xb018148
y.create.l HWIO_APCS_RBCPR_LOG_3_ADDR A:0xb01814c
y.create.l HWIO_APCS_RBCPR_LOG_4_ADDR A:0xb018150
y.create.l HWIO_APCS_RBCPR_LOG_5_ADDR A:0xb018154
y.create.l HWIO_APCS_RBCPR_LOG_6_ADDR A:0xb018158
y.create.l HWIO_APCS_RBCPR_LOG_7_ADDR A:0xb01815c
y.create.l HWIO_APCS_RBCPR_HTOL_AGE_ADDR A:0xb018160
y.create.l HWIO_BIMC_HW_VERSION_ADDR A:0x400000
y.create.l HWIO_BIMC_CORE_INFO_ADDR A:0x400004
y.create.l HWIO_BIMC_HW_INFO_ADDR A:0x400008
y.create.l HWIO_BIMC_CORE_CLK_SEL_ADDR A:0x400020
y.create.l HWIO_BIMC_CORE_CLK_PERIOD_ADDR A:0x400024
y.create.l HWIO_BIMC_SCMO0_LOCAL_CGC_THRESHOLD_ADDR A:0x400100
y.create.l HWIO_BIMC_DPE0_LOCAL_CGC_THRESHOLD_ADDR A:0x400140
y.create.l HWIO_BIMC_MPORT_CORE_DOMAIN_LOCAL_CGC_THRESHOLD_ADDR A:0x400180
y.create.l HWIO_BIMC_MPORT0_CLK_LOCAL_CGC_THRESHOLD_ADDR A:0x4001c0
y.create.l HWIO_BIMC_MPORT1_CLK_LOCAL_CGC_THRESHOLD_ADDR A:0x4001c4
y.create.l HWIO_BIMC_MPORT2_CLK_LOCAL_CGC_THRESHOLD_ADDR A:0x4001c8
y.create.l HWIO_BIMC_MPORT3_CLK_LOCAL_CGC_THRESHOLD_ADDR A:0x4001cc
y.create.l HWIO_BIMC_MPORT4_CLK_LOCAL_CGC_THRESHOLD_ADDR A:0x4001d0
y.create.l HWIO_BIMC_MPORT5_CLK_LOCAL_CGC_THRESHOLD_ADDR A:0x4001d4
y.create.l HWIO_BIMC_SWAY_LOCAL_CGC_THRESHOLD_ADDR A:0x400200
y.create.l HWIO_BIMC_SCMO0_CGC_CFG_ADDR A:0x400240
y.create.l HWIO_BIMC_DPE0_CGC_CFG_ADDR A:0x400280
y.create.l HWIO_BIMC_CALIBRATION_CFG_ADDR A:0x400400
y.create.l HWIO_BIMC_DFI0_LP_CFG_ADDR A:0x400600
y.create.l HWIO_BIMC_HFSC_CFG_ADDR A:0x400800
y.create.l HWIO_BIMC_HFSC_STATUS_ADDR A:0x40080c
y.create.l HWIO_BIMC_HFSC_STAGE1_CTRL_ADDR A:0x400840
y.create.l HWIO_BIMC_HFSC_STAGE2_CTRL_ADDR A:0x400860
y.create.l HWIO_BIMC_BRIC_GLOBAL1_COMPONENT_INFO_ADDR A:0x401000
y.create.l HWIO_BIMC_BRIC_HW_INFO_ADDR A:0x401010
y.create.l HWIO_BIMC_BRIC_HW_VERSION_ADDR A:0x401014
y.create.l HWIO_BIMC_BRIC_CONFIGURATION_INFO_0_ADDR A:0x401020
y.create.l HWIO_BIMC_BRIC_CONFIGURATION_INFO_1_ADDR A:0x401030
y.create.l HWIO_BIMC_BRIC_CONFIGURATION_INFO_2A_ADDR A:0x401040
y.create.l HWIO_BIMC_BRIC_CONFIGURATION_INFO_2B_ADDR A:0x401044
y.create.l HWIO_BIMC_BRIC_CONFIGURATION_INFO_2C_ADDR A:0x401048
y.create.l HWIO_BIMC_BRIC_CONFIGURATION_INFO_2D_ADDR A:0x40104c
y.create.l HWIO_BIMC_BRIC_INTERRUPT_0_STATUS_0_ADDR A:0x401100
y.create.l HWIO_BIMC_BRIC_INTERRUPT_0_CLEAR_0_ADDR A:0x401108
y.create.l HWIO_BIMC_BRIC_INTERRUPT_0_ENABLE_0_ADDR A:0x40110c
y.create.l HWIO_BIMC_BRIC_INTERRUPT_0_STATUS_1_ADDR A:0x401110
y.create.l HWIO_BIMC_BRIC_INTERRUPT_0_CLEAR_1_ADDR A:0x401118
y.create.l HWIO_BIMC_BRIC_INTERRUPT_0_ENABLE_1_ADDR A:0x40111c
y.create.l HWIO_BIMC_BRIC_INTERRUPT_0_STATUS_2_ADDR A:0x401120
y.create.l HWIO_BIMC_BRIC_INTERRUPT_0_CLEAR_2_ADDR A:0x401128
y.create.l HWIO_BIMC_BRIC_INTERRUPT_0_ENABLE_2_ADDR A:0x40112c
y.create.l HWIO_BIMC_BRIC_INTERRUPT_0_STATUS_3_ADDR A:0x401130
y.create.l HWIO_BIMC_BRIC_INTERRUPT_0_CLEAR_3_ADDR A:0x401138
y.create.l HWIO_BIMC_BRIC_INTERRUPT_0_ENABLE_3_ADDR A:0x40113c
y.create.l HWIO_BIMC_BRIC_INTERRUPT_0_STATUS_4_ADDR A:0x401140
y.create.l HWIO_BIMC_BRIC_INTERRUPT_0_CLEAR_4_ADDR A:0x401148
y.create.l HWIO_BIMC_BRIC_INTERRUPT_0_ENABLE_4_ADDR A:0x40114c
y.create.l HWIO_BIMC_BRIC_INTERRUPT_2_STATUS_0_ADDR A:0x401180
y.create.l HWIO_BIMC_BRIC_INTERRUPT_2_CLEAR_0_ADDR A:0x401188
y.create.l HWIO_BIMC_BRIC_INTERRUPT_2_ENABLE_0_ADDR A:0x40118c
y.create.l HWIO_BIMC_BRIC_INTERRUPT_2_STATUS_1_ADDR A:0x401190
y.create.l HWIO_BIMC_BRIC_INTERRUPT_2_CLEAR_1_ADDR A:0x401198
y.create.l HWIO_BIMC_BRIC_INTERRUPT_2_ENABLE_1_ADDR A:0x40119c
y.create.l HWIO_BIMC_BRIC_INTERRUPT_2_STATUS_2_ADDR A:0x4011a0
y.create.l HWIO_BIMC_BRIC_INTERRUPT_2_CLEAR_2_ADDR A:0x4011a8
y.create.l HWIO_BIMC_BRIC_INTERRUPT_2_ENABLE_2_ADDR A:0x4011ac
y.create.l HWIO_BIMC_BRIC_INTERRUPT_2_STATUS_3_ADDR A:0x4011b0
y.create.l HWIO_BIMC_BRIC_INTERRUPT_2_CLEAR_3_ADDR A:0x4011b8
y.create.l HWIO_BIMC_BRIC_INTERRUPT_2_ENABLE_3_ADDR A:0x4011bc
y.create.l HWIO_BIMC_BRIC_INTERRUPT_2_STATUS_4_ADDR A:0x4011c0
y.create.l HWIO_BIMC_BRIC_INTERRUPT_2_CLEAR_4_ADDR A:0x4011c8
y.create.l HWIO_BIMC_BRIC_INTERRUPT_2_ENABLE_4_ADDR A:0x4011cc
y.create.l HWIO_BIMC_BRIC_REF_TIMER_INTERVAL_ADDR A:0x401200
y.create.l HWIO_BIMC_BRIC_DEBUG_SELECT_ADDR A:0x401210
y.create.l HWIO_BIMC_BRIC_MSA_LOCKS_ADDR A:0x401300
y.create.l HWIO_BIMC_BRIC_PROTNS_LOCKS_ADDR A:0x401310
y.create.l HWIO_BIMC_BRIC_GLOBAL2_COMPONENT_INFO_ADDR A:0x402000
y.create.l HWIO_BIMC_BRIC_INTERRUPT_1_STATUS_0_ADDR A:0x402100
y.create.l HWIO_BIMC_BRIC_INTERRUPT_1_CLEAR_0_ADDR A:0x402108
y.create.l HWIO_BIMC_BRIC_INTERRUPT_1_ENABLE_0_ADDR A:0x40210c
y.create.l HWIO_BIMC_BRIC_INTERRUPT_1_STATUS_1_ADDR A:0x402110
y.create.l HWIO_BIMC_BRIC_INTERRUPT_1_CLEAR_1_ADDR A:0x402118
y.create.l HWIO_BIMC_BRIC_INTERRUPT_1_ENABLE_1_ADDR A:0x40211c
y.create.l HWIO_BIMC_BRIC_INTERRUPT_1_STATUS_2_ADDR A:0x402120
y.create.l HWIO_BIMC_BRIC_INTERRUPT_1_CLEAR_2_ADDR A:0x402128
y.create.l HWIO_BIMC_BRIC_INTERRUPT_1_ENABLE_2_ADDR A:0x40212c
y.create.l HWIO_BIMC_BRIC_INTERRUPT_1_STATUS_3_ADDR A:0x402130
y.create.l HWIO_BIMC_BRIC_INTERRUPT_1_CLEAR_3_ADDR A:0x402138
y.create.l HWIO_BIMC_BRIC_INTERRUPT_1_ENABLE_3_ADDR A:0x40213c
y.create.l HWIO_BIMC_BRIC_INTERRUPT_1_STATUS_4_ADDR A:0x402140
y.create.l HWIO_BIMC_BRIC_INTERRUPT_1_CLEAR_4_ADDR A:0x402148
y.create.l HWIO_BIMC_BRIC_INTERRUPT_1_ENABLE_4_ADDR A:0x40214c
y.create.l HWIO_BIMC_BRIC_DEFAULT_SEGMENT_ADDR A:0x4021f0
y.create.l HWIO_BIMC_BRIC_SEGMENT0_ADDR_BASE_A_LOWER_ADDR A:0x402200
y.create.l HWIO_BIMC_BRIC_SEGMENT1_ADDR_BASE_A_LOWER_ADDR A:0x402280
y.create.l HWIO_BIMC_BRIC_SEGMENT2_ADDR_BASE_A_LOWER_ADDR A:0x402300
y.create.l HWIO_BIMC_BRIC_SEGMENT0_ADDR_BASE_A_UPPER_ADDR A:0x402204
y.create.l HWIO_BIMC_BRIC_SEGMENT1_ADDR_BASE_A_UPPER_ADDR A:0x402284
y.create.l HWIO_BIMC_BRIC_SEGMENT2_ADDR_BASE_A_UPPER_ADDR A:0x402304
y.create.l HWIO_BIMC_BRIC_SEGMENT0_ADDR_MASK_A_LOWER_ADDR A:0x402208
y.create.l HWIO_BIMC_BRIC_SEGMENT1_ADDR_MASK_A_LOWER_ADDR A:0x402288
y.create.l HWIO_BIMC_BRIC_SEGMENT2_ADDR_MASK_A_LOWER_ADDR A:0x402308
y.create.l HWIO_BIMC_BRIC_SEGMENT0_ADDR_MASK_A_UPPER_ADDR A:0x40220c
y.create.l HWIO_BIMC_BRIC_SEGMENT1_ADDR_MASK_A_UPPER_ADDR A:0x40228c
y.create.l HWIO_BIMC_BRIC_SEGMENT2_ADDR_MASK_A_UPPER_ADDR A:0x40230c
y.create.l HWIO_BIMC_BRIC_SEGMENT0_ADDR_BASE_B_LOWER_ADDR A:0x402210
y.create.l HWIO_BIMC_BRIC_SEGMENT1_ADDR_BASE_B_LOWER_ADDR A:0x402290
y.create.l HWIO_BIMC_BRIC_SEGMENT2_ADDR_BASE_B_LOWER_ADDR A:0x402310
y.create.l HWIO_BIMC_BRIC_SEGMENT0_ADDR_BASE_B_UPPER_ADDR A:0x402214
y.create.l HWIO_BIMC_BRIC_SEGMENT1_ADDR_BASE_B_UPPER_ADDR A:0x402294
y.create.l HWIO_BIMC_BRIC_SEGMENT2_ADDR_BASE_B_UPPER_ADDR A:0x402314
y.create.l HWIO_BIMC_BRIC_SEGMENT0_ADDR_MASK_B_LOWER_ADDR A:0x402218
y.create.l HWIO_BIMC_BRIC_SEGMENT1_ADDR_MASK_B_LOWER_ADDR A:0x402298
y.create.l HWIO_BIMC_BRIC_SEGMENT2_ADDR_MASK_B_LOWER_ADDR A:0x402318
y.create.l HWIO_BIMC_BRIC_SEGMENT0_ADDR_MASK_B_UPPER_ADDR A:0x40221c
y.create.l HWIO_BIMC_BRIC_SEGMENT1_ADDR_MASK_B_UPPER_ADDR A:0x40229c
y.create.l HWIO_BIMC_BRIC_SEGMENT2_ADDR_MASK_B_UPPER_ADDR A:0x40231c
y.create.l HWIO_BIMC_BRIC_SEGMENT0_ADDR_BASE_C_LOWER_ADDR A:0x402220
y.create.l HWIO_BIMC_BRIC_SEGMENT1_ADDR_BASE_C_LOWER_ADDR A:0x4022a0
y.create.l HWIO_BIMC_BRIC_SEGMENT2_ADDR_BASE_C_LOWER_ADDR A:0x402320
y.create.l HWIO_BIMC_BRIC_SEGMENT0_ADDR_BASE_C_UPPER_ADDR A:0x402224
y.create.l HWIO_BIMC_BRIC_SEGMENT1_ADDR_BASE_C_UPPER_ADDR A:0x4022a4
y.create.l HWIO_BIMC_BRIC_SEGMENT2_ADDR_BASE_C_UPPER_ADDR A:0x402324
y.create.l HWIO_BIMC_BRIC_SEGMENT0_ADDR_MASK_C_LOWER_ADDR A:0x402228
y.create.l HWIO_BIMC_BRIC_SEGMENT1_ADDR_MASK_C_LOWER_ADDR A:0x4022a8
y.create.l HWIO_BIMC_BRIC_SEGMENT2_ADDR_MASK_C_LOWER_ADDR A:0x402328
y.create.l HWIO_BIMC_BRIC_SEGMENT0_ADDR_MASK_C_UPPER_ADDR A:0x40222c
y.create.l HWIO_BIMC_BRIC_SEGMENT1_ADDR_MASK_C_UPPER_ADDR A:0x4022ac
y.create.l HWIO_BIMC_BRIC_SEGMENT2_ADDR_MASK_C_UPPER_ADDR A:0x40232c
y.create.l HWIO_BIMC_BRIC_REMAP0_ADDR_BASE_LOWER_ADDR A:0x402a00
y.create.l HWIO_BIMC_BRIC_REMAP1_ADDR_BASE_LOWER_ADDR A:0x402a40
y.create.l HWIO_BIMC_BRIC_REMAP2_ADDR_BASE_LOWER_ADDR A:0x402a80
y.create.l HWIO_BIMC_BRIC_REMAP3_ADDR_BASE_LOWER_ADDR A:0x402ac0
y.create.l HWIO_BIMC_BRIC_REMAP0_ADDR_BASE_UPPER_ADDR A:0x402a04
y.create.l HWIO_BIMC_BRIC_REMAP1_ADDR_BASE_UPPER_ADDR A:0x402a44
y.create.l HWIO_BIMC_BRIC_REMAP2_ADDR_BASE_UPPER_ADDR A:0x402a84
y.create.l HWIO_BIMC_BRIC_REMAP3_ADDR_BASE_UPPER_ADDR A:0x402ac4
y.create.l HWIO_BIMC_BRIC_REMAP0_ADDR_MASK_LOWER_ADDR A:0x402a08
y.create.l HWIO_BIMC_BRIC_REMAP1_ADDR_MASK_LOWER_ADDR A:0x402a48
y.create.l HWIO_BIMC_BRIC_REMAP2_ADDR_MASK_LOWER_ADDR A:0x402a88
y.create.l HWIO_BIMC_BRIC_REMAP3_ADDR_MASK_LOWER_ADDR A:0x402ac8
y.create.l HWIO_BIMC_BRIC_REMAP0_ADDR_MASK_UPPER_ADDR A:0x402a0c
y.create.l HWIO_BIMC_BRIC_REMAP1_ADDR_MASK_UPPER_ADDR A:0x402a4c
y.create.l HWIO_BIMC_BRIC_REMAP2_ADDR_MASK_UPPER_ADDR A:0x402a8c
y.create.l HWIO_BIMC_BRIC_REMAP3_ADDR_MASK_UPPER_ADDR A:0x402acc
y.create.l HWIO_BIMC_BRIC_REMAP0_OP0_ADDR A:0x402a20
y.create.l HWIO_BIMC_BRIC_REMAP1_OP0_ADDR A:0x402a60
y.create.l HWIO_BIMC_BRIC_REMAP2_OP0_ADDR A:0x402aa0
y.create.l HWIO_BIMC_BRIC_REMAP3_OP0_ADDR A:0x402ae0
y.create.l HWIO_BIMC_BRIC_REMAP0_OP1_ADDR A:0x402a24
y.create.l HWIO_BIMC_BRIC_REMAP1_OP1_ADDR A:0x402a64
y.create.l HWIO_BIMC_BRIC_REMAP2_OP1_ADDR A:0x402aa4
y.create.l HWIO_BIMC_BRIC_REMAP3_OP1_ADDR A:0x402ae4
y.create.l HWIO_BIMC_PERFMON_COMPONENT_INFO_ADDR A:0x403000
y.create.l HWIO_BIMC_PERFMON_CONFIGURATION_INFO_ADDR A:0x403020
y.create.l HWIO_BIMC_PERFMON_CLOCK_CTRL_ADDR A:0x403200
y.create.l HWIO_BIMC_PERFMON_MODE_ADDR A:0x403210
y.create.l HWIO_BIMC_PERFMON_DUMP_ADDR A:0x403214
y.create.l HWIO_BIMC_PERFMON_TIMED_MODE_INTERVAL_ADDR A:0x403220
y.create.l HWIO_BIMC_PERFMON_TIMED_MODE_ITERATIONS_ADDR A:0x403230
y.create.l HWIO_BIMC_PERFMON_STATUS_ADDR A:0x4032f0
y.create.l HWIO_BIMC_PERFMON_COUNTER_0_CONFIG_ADDR A:0x403300
y.create.l HWIO_BIMC_PERFMON_COUNTER_1_CONFIG_ADDR A:0x403310
y.create.l HWIO_BIMC_PERFMON_COUNTER_2_CONFIG_ADDR A:0x403320
y.create.l HWIO_BIMC_PERFMON_COUNTER_3_CONFIG_ADDR A:0x403330
y.create.l HWIO_BIMC_PERFMON_COUNTER_4_CONFIG_ADDR A:0x403340
y.create.l HWIO_BIMC_PERFMON_COUNTER_5_CONFIG_ADDR A:0x403350
y.create.l HWIO_BIMC_PERFMON_COUNTER_6_CONFIG_ADDR A:0x403360
y.create.l HWIO_BIMC_PERFMON_COUNTER_7_CONFIG_ADDR A:0x403370
y.create.l HWIO_BIMC_PERFMON_COUNTER_8_CONFIG_ADDR A:0x403380
y.create.l HWIO_BIMC_PERFMON_COUNTER_9_CONFIG_ADDR A:0x403390
y.create.l HWIO_BIMC_PERFMON_COUNTER_0_ADDR A:0x403308
y.create.l HWIO_BIMC_PERFMON_COUNTER_1_ADDR A:0x403318
y.create.l HWIO_BIMC_PERFMON_COUNTER_2_ADDR A:0x403328
y.create.l HWIO_BIMC_PERFMON_COUNTER_3_ADDR A:0x403338
y.create.l HWIO_BIMC_PERFMON_COUNTER_4_ADDR A:0x403348
y.create.l HWIO_BIMC_PERFMON_COUNTER_5_ADDR A:0x403358
y.create.l HWIO_BIMC_PERFMON_COUNTER_6_ADDR A:0x403368
y.create.l HWIO_BIMC_PERFMON_COUNTER_7_ADDR A:0x403378
y.create.l HWIO_BIMC_PERFMON_COUNTER_8_ADDR A:0x403388
y.create.l HWIO_BIMC_PERFMON_COUNTER_9_ADDR A:0x403398
y.create.l HWIO_BIMC_PERFMON_COUNTER_0_OVERFLOW_ADDR A:0x40330c
y.create.l HWIO_BIMC_PERFMON_COUNTER_1_OVERFLOW_ADDR A:0x40331c
y.create.l HWIO_BIMC_PERFMON_COUNTER_2_OVERFLOW_ADDR A:0x40332c
y.create.l HWIO_BIMC_PERFMON_COUNTER_3_OVERFLOW_ADDR A:0x40333c
y.create.l HWIO_BIMC_PERFMON_COUNTER_4_OVERFLOW_ADDR A:0x40334c
y.create.l HWIO_BIMC_PERFMON_COUNTER_5_OVERFLOW_ADDR A:0x40335c
y.create.l HWIO_BIMC_PERFMON_COUNTER_6_OVERFLOW_ADDR A:0x40336c
y.create.l HWIO_BIMC_PERFMON_COUNTER_7_OVERFLOW_ADDR A:0x40337c
y.create.l HWIO_BIMC_PERFMON_COUNTER_8_OVERFLOW_ADDR A:0x40338c
y.create.l HWIO_BIMC_PERFMON_COUNTER_9_OVERFLOW_ADDR A:0x40339c
y.create.l HWIO_BIMC_DTE_HW_INFO_ADDR A:0x406000
y.create.l HWIO_BIMC_DTE_GLOBAL_CNTL_ADDR A:0x406004
y.create.l HWIO_BIMC_DTE_PROGRAM_CNTL_ADDR A:0x40600c
y.create.l HWIO_BIMC_DTE_REG_CNTL_ADDR A:0x406010
y.create.l HWIO_BIMC_DTE_REG_DATA_ADDR A:0x406014
y.create.l HWIO_BIMC_DTE_TEST_STATUS_DDR_ADDR A:0x406020
y.create.l HWIO_BIMC_DTE_TEST_STATUS_QSB_ADDR A:0x406024
y.create.l HWIO_BIMC_DTE_TEST_MEM_CNTL_ADDR A:0x406030
y.create.l HWIO_BIMC_DTE_TEST_MEM_DATA_0_ADDR A:0x406038
y.create.l HWIO_BIMC_DTE_TEST_MEM_DATA_1_ADDR A:0x40603c
y.create.l HWIO_BIMC_M_APP_MPORT_COMPONENT_INFO_ADDR A:0x408000
y.create.l HWIO_BIMC_M_APP_MPORT_CONFIGURATION_INFO_0_ADDR A:0x408020
y.create.l HWIO_BIMC_M_APP_MPORT_CONFIGURATION_INFO_1_ADDR A:0x408030
y.create.l HWIO_BIMC_M_APP_MPORT_CONFIGURATION_INFO_2A_ADDR A:0x408040
y.create.l HWIO_BIMC_M_APP_MPORT_CONFIGURATION_INFO_2B_ADDR A:0x408044
y.create.l HWIO_BIMC_M_APP_MPORT_CONFIGURATION_INFO_3_ADDR A:0x408050
y.create.l HWIO_BIMC_M_APP_MPORT_CONFIGURATION_INFO_4_ADDR A:0x408060
y.create.l HWIO_BIMC_M_APP_MPORT_CONFIGURATION_INFO_5A_ADDR A:0x408070
y.create.l HWIO_BIMC_M_APP_MPORT_CONFIGURATION_INFO_5B_ADDR A:0x408074
y.create.l HWIO_BIMC_M_APP_MPORT_CONFIGURATION_INFO_5C_ADDR A:0x408078
y.create.l HWIO_BIMC_M_APP_MPORT_CONFIGURATION_INFO_5D_ADDR A:0x40807c
y.create.l HWIO_BIMC_M_APP_MPORT_INTERRUPT_STATUS_ADDR A:0x408100
y.create.l HWIO_BIMC_M_APP_MPORT_INTERRUPT_CLEAR_ADDR A:0x408108
y.create.l HWIO_BIMC_M_APP_MPORT_INTERRUPT_ENABLE_ADDR A:0x40810c
y.create.l HWIO_BIMC_M_APP_MPORT_CLOCK_CTRL_ADDR A:0x408200
y.create.l HWIO_BIMC_M_APP_MPORT_CDC_CTRL_ADDR A:0x408208
y.create.l HWIO_BIMC_M_APP_MPORT_MODE_ADDR A:0x408210
y.create.l HWIO_BIMC_M_APP_MPORT_WR_WAY_CROSSING_ADDR A:0x408220
y.create.l HWIO_BIMC_M_APP_MPORT_PRIORITYLVL_OVERRIDE_ADDR A:0x408230
y.create.l HWIO_BIMC_M_APP_MPORT_READ_COMMAND_OVERRIDE_ADDR A:0x408240
y.create.l HWIO_BIMC_M_APP_MPORT_WRITE_COMMAND_OVERRIDE_ADDR A:0x408250
y.create.l HWIO_BIMC_M_APP_MPORT_RD_TRACKING_INDEX_ADDR A:0x408270
y.create.l HWIO_BIMC_M_APP_MPORT_WR_TRACKING_INDEX_ADDR A:0x408274
y.create.l HWIO_BIMC_M_APP_MPORT_BWMON_ENABLE_ADDR A:0x408280
y.create.l HWIO_BIMC_M_APP_MPORT_BWMON_CLEAR_ADDR A:0x408284
y.create.l HWIO_BIMC_M_APP_MPORT_BWMON_BYTE_COUNT_ADDR A:0x408288
y.create.l HWIO_BIMC_M_APP_MPORT_BWMON_THRESHOLD_ADDR A:0x408290
y.create.l HWIO_BIMC_M_APP_MPORT_BWMON_MID_MASK_ADDR A:0x408298
y.create.l HWIO_BIMC_M_APP_MPORT_BWMON_MID_MATCH_ADDR A:0x40829c
y.create.l HWIO_BIMC_M_APP_MPORT_BKE_ENABLE_ADDR A:0x408300
y.create.l HWIO_BIMC_M_APP_MPORT_BKE_GRANT_PERIOD_ADDR A:0x408304
y.create.l HWIO_BIMC_M_APP_MPORT_BKE_GRANT_COUNT_ADDR A:0x408308
y.create.l HWIO_BIMC_M_APP_MPORT_BKE_THRESHOLD_HIGH_ADDR A:0x408320
y.create.l HWIO_BIMC_M_APP_MPORT_BKE_THRESHOLD_MEDIUM_ADDR A:0x408324
y.create.l HWIO_BIMC_M_APP_MPORT_BKE_THRESHOLD_LOW_ADDR A:0x408328
y.create.l HWIO_BIMC_M_APP_MPORT_BKE_HEALTH_0_ADDR A:0x408340
y.create.l HWIO_BIMC_M_APP_MPORT_BKE_HEALTH_1_ADDR A:0x408344
y.create.l HWIO_BIMC_M_APP_MPORT_BKE_HEALTH_2_ADDR A:0x408348
y.create.l HWIO_BIMC_M_APP_MPORT_BKE_HEALTH_3_ADDR A:0x40834c
y.create.l HWIO_BIMC_M_APP_MPORT_STATUS_2A_ADDR A:0x408420
y.create.l HWIO_BIMC_M_APP_MPORT_STATUS_2B_ADDR A:0x408424
y.create.l HWIO_BIMC_M_APP_MPORT_STATUS_3A_ADDR A:0x408430
y.create.l HWIO_BIMC_M_APP_MPORT_STATUS_3B_ADDR A:0x408434
y.create.l HWIO_BIMC_M_APP_MPORT_BKE1_ENABLE_ADDR A:0x408800
y.create.l HWIO_BIMC_M_APP_MPORT_BKE1_GRANT_PERIOD_ADDR A:0x408804
y.create.l HWIO_BIMC_M_APP_MPORT_BKE1_GRANT_COUNT_ADDR A:0x408808
y.create.l HWIO_BIMC_M_APP_MPORT_BKE1_THRESHOLD_HIGH_ADDR A:0x408820
y.create.l HWIO_BIMC_M_APP_MPORT_BKE1_THRESHOLD_MEDIUM_ADDR A:0x408824
y.create.l HWIO_BIMC_M_APP_MPORT_BKE1_THRESHOLD_LOW_ADDR A:0x408828
y.create.l HWIO_BIMC_M_APP_MPORT_BKE1_HEALTH_0_ADDR A:0x408840
y.create.l HWIO_BIMC_M_APP_MPORT_BKE1_HEALTH_1_ADDR A:0x408844
y.create.l HWIO_BIMC_M_APP_MPORT_BKE1_HEALTH_2_ADDR A:0x408848
y.create.l HWIO_BIMC_M_APP_MPORT_BKE1_HEALTH_3_ADDR A:0x40884c
y.create.l HWIO_BIMC_M_APP_MPORT_BKE2_ENABLE_ADDR A:0x408900
y.create.l HWIO_BIMC_M_APP_MPORT_BKE2_GRANT_PERIOD_ADDR A:0x408904
y.create.l HWIO_BIMC_M_APP_MPORT_BKE2_GRANT_COUNT_ADDR A:0x408908
y.create.l HWIO_BIMC_M_APP_MPORT_BKE2_THRESHOLD_HIGH_ADDR A:0x408920
y.create.l HWIO_BIMC_M_APP_MPORT_BKE2_THRESHOLD_MEDIUM_ADDR A:0x408924
y.create.l HWIO_BIMC_M_APP_MPORT_BKE2_THRESHOLD_LOW_ADDR A:0x408928
y.create.l HWIO_BIMC_M_APP_MPORT_BKE2_HEALTH_0_ADDR A:0x408940
y.create.l HWIO_BIMC_M_APP_MPORT_BKE2_HEALTH_1_ADDR A:0x408944
y.create.l HWIO_BIMC_M_APP_MPORT_BKE2_HEALTH_2_ADDR A:0x408948
y.create.l HWIO_BIMC_M_APP_MPORT_BKE2_HEALTH_3_ADDR A:0x40894c
y.create.l HWIO_BIMC_M_APP_MPORT_BKE3_ENABLE_ADDR A:0x408a00
y.create.l HWIO_BIMC_M_APP_MPORT_BKE3_GRANT_PERIOD_ADDR A:0x408a04
y.create.l HWIO_BIMC_M_APP_MPORT_BKE3_GRANT_COUNT_ADDR A:0x408a08
y.create.l HWIO_BIMC_M_APP_MPORT_BKE3_THRESHOLD_HIGH_ADDR A:0x408a20
y.create.l HWIO_BIMC_M_APP_MPORT_BKE3_THRESHOLD_MEDIUM_ADDR A:0x408a24
y.create.l HWIO_BIMC_M_APP_MPORT_BKE3_THRESHOLD_LOW_ADDR A:0x408a28
y.create.l HWIO_BIMC_M_APP_MPORT_BKE3_HEALTH_0_ADDR A:0x408a40
y.create.l HWIO_BIMC_M_APP_MPORT_BKE3_HEALTH_1_ADDR A:0x408a44
y.create.l HWIO_BIMC_M_APP_MPORT_BKE3_HEALTH_2_ADDR A:0x408a48
y.create.l HWIO_BIMC_M_APP_MPORT_BKE3_HEALTH_3_ADDR A:0x408a4c
y.create.l HWIO_BIMC_M_APP_PROF_COMPONENT_INFO_ADDR A:0x409000
y.create.l HWIO_BIMC_M_APP_PROF_CONFIGURATION_INFO_0_ADDR A:0x409020
y.create.l HWIO_BIMC_M_APP_PROF_CONFIGURATION_INFO_1_ADDR A:0x409030
y.create.l HWIO_BIMC_M_APP_PROF_CLOCK_CTRL_ADDR A:0x409200
y.create.l HWIO_BIMC_M_APP_PROF_MODE_ADDR A:0x409210
y.create.l HWIO_BIMC_M_APP_PROF_RD_TENURE_THRESHOLD_ADDR A:0x409214
y.create.l HWIO_BIMC_M_APP_PROF_WR_TENURE_THRESHOLD_ADDR A:0x409218
y.create.l HWIO_BIMC_M_APP_PROF_SWAY_SELECT_ADDR A:0x409220
y.create.l HWIO_BIMC_M_APP_PROF_MID_MASK_ADDR A:0x409230
y.create.l HWIO_BIMC_M_APP_PROF_MID_MATCH_ADDR A:0x409234
y.create.l HWIO_BIMC_M_APP_PROF_MID_INV_MATCH_ADDR A:0x409238
y.create.l HWIO_BIMC_M_APP_PROF_ADDR_MASK_LOWER_ADDR A:0x409240
y.create.l HWIO_BIMC_M_APP_PROF_ADDR_MASK_UPPER_ADDR A:0x409244
y.create.l HWIO_BIMC_M_APP_PROF_ADDR_MATCH_LOWER_ADDR A:0x409248
y.create.l HWIO_BIMC_M_APP_PROF_ADDR_MATCH_UPPER_ADDR A:0x40924c
y.create.l HWIO_BIMC_M_APP_PROF_ADDR_INV_MATCH_ADDR A:0x409250
y.create.l HWIO_BIMC_M_APP_PROF_ACH_MASK_0_ADDR A:0x409260
y.create.l HWIO_BIMC_M_APP_PROF_ACH_MATCH_0_ADDR A:0x409264
y.create.l HWIO_BIMC_M_APP_PROF_ACH_MASK_1_ADDR A:0x409270
y.create.l HWIO_BIMC_M_APP_PROF_ACH_MATCH_1_ADDR A:0x409274
y.create.l HWIO_BIMC_M_APP_PROF_ACH_INV_MATCH_1_ADDR A:0x409278
y.create.l HWIO_BIMC_M_APP_PROF_ACH_MASK_2_ADDR A:0x409280
y.create.l HWIO_BIMC_M_APP_PROF_ACH_MATCH_2_ADDR A:0x409284
y.create.l HWIO_BIMC_M_APP_PROF_ACH_MASK_3_ADDR A:0x409290
y.create.l HWIO_BIMC_M_APP_PROF_ACH_MATCH_3_ADDR A:0x409294
y.create.l HWIO_BIMC_M_APP_PROF_ACH_INV_MATCH_3_ADDR A:0x409298
y.create.l HWIO_BIMC_M_APP_PROF_ACH_MASK_4_ADDR A:0x4092a0
y.create.l HWIO_BIMC_M_APP_PROF_ACH_MATCH_4_ADDR A:0x4092a4
y.create.l HWIO_BIMC_M_APP_PROF_ACH_INV_MATCH_4_ADDR A:0x4092a8
y.create.l HWIO_BIMC_M_APP_PROF_BCH_MASK_ADDR A:0x409300
y.create.l HWIO_BIMC_M_APP_PROF_BCH_MATCH_ADDR A:0x409304
y.create.l HWIO_BIMC_M_APP_PROF_BCH_INV_MATCH_ADDR A:0x409308
y.create.l HWIO_BIMC_M_APP_PROF_RCH_MASK_ADDR A:0x409340
y.create.l HWIO_BIMC_M_APP_PROF_RCH_MATCH_ADDR A:0x409344
y.create.l HWIO_BIMC_M_APP_PROF_RCH_INV_MATCH_ADDR A:0x409348
y.create.l HWIO_BIMC_M_APP_PROF_RD_STATUS_0_ADDR A:0x409400
y.create.l HWIO_BIMC_M_APP_PROF_WR_STATUS_0_ADDR A:0x409410
y.create.l HWIO_BIMC_M_DSP_MPORT_COMPONENT_INFO_ADDR A:0x40c000
y.create.l HWIO_BIMC_M_DSP_MPORT_CONFIGURATION_INFO_0_ADDR A:0x40c020
y.create.l HWIO_BIMC_M_DSP_MPORT_CONFIGURATION_INFO_1_ADDR A:0x40c030
y.create.l HWIO_BIMC_M_DSP_MPORT_CONFIGURATION_INFO_2A_ADDR A:0x40c040
y.create.l HWIO_BIMC_M_DSP_MPORT_CONFIGURATION_INFO_2B_ADDR A:0x40c044
y.create.l HWIO_BIMC_M_DSP_MPORT_CONFIGURATION_INFO_3_ADDR A:0x40c050
y.create.l HWIO_BIMC_M_DSP_MPORT_CONFIGURATION_INFO_4_ADDR A:0x40c060
y.create.l HWIO_BIMC_M_DSP_MPORT_CONFIGURATION_INFO_5A_ADDR A:0x40c070
y.create.l HWIO_BIMC_M_DSP_MPORT_CONFIGURATION_INFO_5B_ADDR A:0x40c074
y.create.l HWIO_BIMC_M_DSP_MPORT_CONFIGURATION_INFO_5C_ADDR A:0x40c078
y.create.l HWIO_BIMC_M_DSP_MPORT_CONFIGURATION_INFO_5D_ADDR A:0x40c07c
y.create.l HWIO_BIMC_M_DSP_MPORT_INTERRUPT_STATUS_ADDR A:0x40c100
y.create.l HWIO_BIMC_M_DSP_MPORT_INTERRUPT_CLEAR_ADDR A:0x40c108
y.create.l HWIO_BIMC_M_DSP_MPORT_INTERRUPT_ENABLE_ADDR A:0x40c10c
y.create.l HWIO_BIMC_M_DSP_MPORT_CLOCK_CTRL_ADDR A:0x40c200
y.create.l HWIO_BIMC_M_DSP_MPORT_CDC_CTRL_ADDR A:0x40c208
y.create.l HWIO_BIMC_M_DSP_MPORT_MODE_ADDR A:0x40c210
y.create.l HWIO_BIMC_M_DSP_MPORT_WR_WAY_CROSSING_ADDR A:0x40c220
y.create.l HWIO_BIMC_M_DSP_MPORT_PRIORITYLVL_OVERRIDE_ADDR A:0x40c230
y.create.l HWIO_BIMC_M_DSP_MPORT_READ_COMMAND_OVERRIDE_ADDR A:0x40c240
y.create.l HWIO_BIMC_M_DSP_MPORT_WRITE_COMMAND_OVERRIDE_ADDR A:0x40c250
y.create.l HWIO_BIMC_M_DSP_MPORT_RD_TRACKING_INDEX_ADDR A:0x40c270
y.create.l HWIO_BIMC_M_DSP_MPORT_WR_TRACKING_INDEX_ADDR A:0x40c274
y.create.l HWIO_BIMC_M_DSP_MPORT_BWMON_ENABLE_ADDR A:0x40c280
y.create.l HWIO_BIMC_M_DSP_MPORT_BWMON_CLEAR_ADDR A:0x40c284
y.create.l HWIO_BIMC_M_DSP_MPORT_BWMON_BYTE_COUNT_ADDR A:0x40c288
y.create.l HWIO_BIMC_M_DSP_MPORT_BWMON_THRESHOLD_ADDR A:0x40c290
y.create.l HWIO_BIMC_M_DSP_MPORT_BWMON_MID_MASK_ADDR A:0x40c298
y.create.l HWIO_BIMC_M_DSP_MPORT_BWMON_MID_MATCH_ADDR A:0x40c29c
y.create.l HWIO_BIMC_M_DSP_MPORT_BKE_ENABLE_ADDR A:0x40c300
y.create.l HWIO_BIMC_M_DSP_MPORT_BKE_GRANT_PERIOD_ADDR A:0x40c304
y.create.l HWIO_BIMC_M_DSP_MPORT_BKE_GRANT_COUNT_ADDR A:0x40c308
y.create.l HWIO_BIMC_M_DSP_MPORT_BKE_THRESHOLD_HIGH_ADDR A:0x40c320
y.create.l HWIO_BIMC_M_DSP_MPORT_BKE_THRESHOLD_MEDIUM_ADDR A:0x40c324
y.create.l HWIO_BIMC_M_DSP_MPORT_BKE_THRESHOLD_LOW_ADDR A:0x40c328
y.create.l HWIO_BIMC_M_DSP_MPORT_BKE_HEALTH_0_ADDR A:0x40c340
y.create.l HWIO_BIMC_M_DSP_MPORT_BKE_HEALTH_1_ADDR A:0x40c344
y.create.l HWIO_BIMC_M_DSP_MPORT_BKE_HEALTH_2_ADDR A:0x40c348
y.create.l HWIO_BIMC_M_DSP_MPORT_BKE_HEALTH_3_ADDR A:0x40c34c
y.create.l HWIO_BIMC_M_DSP_MPORT_STATUS_2A_ADDR A:0x40c420
y.create.l HWIO_BIMC_M_DSP_MPORT_STATUS_2B_ADDR A:0x40c424
y.create.l HWIO_BIMC_M_DSP_MPORT_STATUS_3A_ADDR A:0x40c430
y.create.l HWIO_BIMC_M_DSP_MPORT_STATUS_3B_ADDR A:0x40c434
y.create.l HWIO_BIMC_M_DSP_MPORT_BKE1_ENABLE_ADDR A:0x40c800
y.create.l HWIO_BIMC_M_DSP_MPORT_BKE1_GRANT_PERIOD_ADDR A:0x40c804
y.create.l HWIO_BIMC_M_DSP_MPORT_BKE1_GRANT_COUNT_ADDR A:0x40c808
y.create.l HWIO_BIMC_M_DSP_MPORT_BKE1_THRESHOLD_HIGH_ADDR A:0x40c820
y.create.l HWIO_BIMC_M_DSP_MPORT_BKE1_THRESHOLD_MEDIUM_ADDR A:0x40c824
y.create.l HWIO_BIMC_M_DSP_MPORT_BKE1_THRESHOLD_LOW_ADDR A:0x40c828
y.create.l HWIO_BIMC_M_DSP_MPORT_BKE1_HEALTH_0_ADDR A:0x40c840
y.create.l HWIO_BIMC_M_DSP_MPORT_BKE1_HEALTH_1_ADDR A:0x40c844
y.create.l HWIO_BIMC_M_DSP_MPORT_BKE1_HEALTH_2_ADDR A:0x40c848
y.create.l HWIO_BIMC_M_DSP_MPORT_BKE1_HEALTH_3_ADDR A:0x40c84c
y.create.l HWIO_BIMC_M_DSP_MPORT_BKE2_ENABLE_ADDR A:0x40c900
y.create.l HWIO_BIMC_M_DSP_MPORT_BKE2_GRANT_PERIOD_ADDR A:0x40c904
y.create.l HWIO_BIMC_M_DSP_MPORT_BKE2_GRANT_COUNT_ADDR A:0x40c908
y.create.l HWIO_BIMC_M_DSP_MPORT_BKE2_THRESHOLD_HIGH_ADDR A:0x40c920
y.create.l HWIO_BIMC_M_DSP_MPORT_BKE2_THRESHOLD_MEDIUM_ADDR A:0x40c924
y.create.l HWIO_BIMC_M_DSP_MPORT_BKE2_THRESHOLD_LOW_ADDR A:0x40c928
y.create.l HWIO_BIMC_M_DSP_MPORT_BKE2_HEALTH_0_ADDR A:0x40c940
y.create.l HWIO_BIMC_M_DSP_MPORT_BKE2_HEALTH_1_ADDR A:0x40c944
y.create.l HWIO_BIMC_M_DSP_MPORT_BKE2_HEALTH_2_ADDR A:0x40c948
y.create.l HWIO_BIMC_M_DSP_MPORT_BKE2_HEALTH_3_ADDR A:0x40c94c
y.create.l HWIO_BIMC_M_DSP_MPORT_BKE3_ENABLE_ADDR A:0x40ca00
y.create.l HWIO_BIMC_M_DSP_MPORT_BKE3_GRANT_PERIOD_ADDR A:0x40ca04
y.create.l HWIO_BIMC_M_DSP_MPORT_BKE3_GRANT_COUNT_ADDR A:0x40ca08
y.create.l HWIO_BIMC_M_DSP_MPORT_BKE3_THRESHOLD_HIGH_ADDR A:0x40ca20
y.create.l HWIO_BIMC_M_DSP_MPORT_BKE3_THRESHOLD_MEDIUM_ADDR A:0x40ca24
y.create.l HWIO_BIMC_M_DSP_MPORT_BKE3_THRESHOLD_LOW_ADDR A:0x40ca28
y.create.l HWIO_BIMC_M_DSP_MPORT_BKE3_HEALTH_0_ADDR A:0x40ca40
y.create.l HWIO_BIMC_M_DSP_MPORT_BKE3_HEALTH_1_ADDR A:0x40ca44
y.create.l HWIO_BIMC_M_DSP_MPORT_BKE3_HEALTH_2_ADDR A:0x40ca48
y.create.l HWIO_BIMC_M_DSP_MPORT_BKE3_HEALTH_3_ADDR A:0x40ca4c
y.create.l HWIO_BIMC_M_DSP_PROF_COMPONENT_INFO_ADDR A:0x40d000
y.create.l HWIO_BIMC_M_DSP_PROF_CONFIGURATION_INFO_0_ADDR A:0x40d020
y.create.l HWIO_BIMC_M_DSP_PROF_CONFIGURATION_INFO_1_ADDR A:0x40d030
y.create.l HWIO_BIMC_M_DSP_PROF_CLOCK_CTRL_ADDR A:0x40d200
y.create.l HWIO_BIMC_M_DSP_PROF_MODE_ADDR A:0x40d210
y.create.l HWIO_BIMC_M_DSP_PROF_RD_TENURE_THRESHOLD_ADDR A:0x40d214
y.create.l HWIO_BIMC_M_DSP_PROF_WR_TENURE_THRESHOLD_ADDR A:0x40d218
y.create.l HWIO_BIMC_M_DSP_PROF_SWAY_SELECT_ADDR A:0x40d220
y.create.l HWIO_BIMC_M_DSP_PROF_MID_MASK_ADDR A:0x40d230
y.create.l HWIO_BIMC_M_DSP_PROF_MID_MATCH_ADDR A:0x40d234
y.create.l HWIO_BIMC_M_DSP_PROF_MID_INV_MATCH_ADDR A:0x40d238
y.create.l HWIO_BIMC_M_DSP_PROF_ADDR_MASK_LOWER_ADDR A:0x40d240
y.create.l HWIO_BIMC_M_DSP_PROF_ADDR_MASK_UPPER_ADDR A:0x40d244
y.create.l HWIO_BIMC_M_DSP_PROF_ADDR_MATCH_LOWER_ADDR A:0x40d248
y.create.l HWIO_BIMC_M_DSP_PROF_ADDR_MATCH_UPPER_ADDR A:0x40d24c
y.create.l HWIO_BIMC_M_DSP_PROF_ADDR_INV_MATCH_ADDR A:0x40d250
y.create.l HWIO_BIMC_M_DSP_PROF_ACH_MASK_0_ADDR A:0x40d260
y.create.l HWIO_BIMC_M_DSP_PROF_ACH_MATCH_0_ADDR A:0x40d264
y.create.l HWIO_BIMC_M_DSP_PROF_ACH_MASK_1_ADDR A:0x40d270
y.create.l HWIO_BIMC_M_DSP_PROF_ACH_MATCH_1_ADDR A:0x40d274
y.create.l HWIO_BIMC_M_DSP_PROF_ACH_INV_MATCH_1_ADDR A:0x40d278
y.create.l HWIO_BIMC_M_DSP_PROF_ACH_MASK_2_ADDR A:0x40d280
y.create.l HWIO_BIMC_M_DSP_PROF_ACH_MATCH_2_ADDR A:0x40d284
y.create.l HWIO_BIMC_M_DSP_PROF_ACH_MASK_3_ADDR A:0x40d290
y.create.l HWIO_BIMC_M_DSP_PROF_ACH_MATCH_3_ADDR A:0x40d294
y.create.l HWIO_BIMC_M_DSP_PROF_ACH_INV_MATCH_3_ADDR A:0x40d298
y.create.l HWIO_BIMC_M_DSP_PROF_ACH_MASK_4_ADDR A:0x40d2a0
y.create.l HWIO_BIMC_M_DSP_PROF_ACH_MATCH_4_ADDR A:0x40d2a4
y.create.l HWIO_BIMC_M_DSP_PROF_ACH_INV_MATCH_4_ADDR A:0x40d2a8
y.create.l HWIO_BIMC_M_DSP_PROF_BCH_MASK_ADDR A:0x40d300
y.create.l HWIO_BIMC_M_DSP_PROF_BCH_MATCH_ADDR A:0x40d304
y.create.l HWIO_BIMC_M_DSP_PROF_BCH_INV_MATCH_ADDR A:0x40d308
y.create.l HWIO_BIMC_M_DSP_PROF_RCH_MASK_ADDR A:0x40d340
y.create.l HWIO_BIMC_M_DSP_PROF_RCH_MATCH_ADDR A:0x40d344
y.create.l HWIO_BIMC_M_DSP_PROF_RCH_INV_MATCH_ADDR A:0x40d348
y.create.l HWIO_BIMC_M_DSP_PROF_RD_STATUS_0_ADDR A:0x40d400
y.create.l HWIO_BIMC_M_DSP_PROF_WR_STATUS_0_ADDR A:0x40d410
y.create.l HWIO_BIMC_M_MCDMA_MPORT_COMPONENT_INFO_ADDR A:0x410000
y.create.l HWIO_BIMC_M_MCDMA_MPORT_CONFIGURATION_INFO_0_ADDR A:0x410020
y.create.l HWIO_BIMC_M_MCDMA_MPORT_CONFIGURATION_INFO_1_ADDR A:0x410030
y.create.l HWIO_BIMC_M_MCDMA_MPORT_CONFIGURATION_INFO_2A_ADDR A:0x410040
y.create.l HWIO_BIMC_M_MCDMA_MPORT_CONFIGURATION_INFO_2B_ADDR A:0x410044
y.create.l HWIO_BIMC_M_MCDMA_MPORT_CONFIGURATION_INFO_3_ADDR A:0x410050
y.create.l HWIO_BIMC_M_MCDMA_MPORT_CONFIGURATION_INFO_4_ADDR A:0x410060
y.create.l HWIO_BIMC_M_MCDMA_MPORT_CONFIGURATION_INFO_5A_ADDR A:0x410070
y.create.l HWIO_BIMC_M_MCDMA_MPORT_CONFIGURATION_INFO_5B_ADDR A:0x410074
y.create.l HWIO_BIMC_M_MCDMA_MPORT_CONFIGURATION_INFO_5C_ADDR A:0x410078
y.create.l HWIO_BIMC_M_MCDMA_MPORT_CONFIGURATION_INFO_5D_ADDR A:0x41007c
y.create.l HWIO_BIMC_M_MCDMA_MPORT_INTERRUPT_STATUS_ADDR A:0x410100
y.create.l HWIO_BIMC_M_MCDMA_MPORT_INTERRUPT_CLEAR_ADDR A:0x410108
y.create.l HWIO_BIMC_M_MCDMA_MPORT_INTERRUPT_ENABLE_ADDR A:0x41010c
y.create.l HWIO_BIMC_M_MCDMA_MPORT_CLOCK_CTRL_ADDR A:0x410200
y.create.l HWIO_BIMC_M_MCDMA_MPORT_CDC_CTRL_ADDR A:0x410208
y.create.l HWIO_BIMC_M_MCDMA_MPORT_MODE_ADDR A:0x410210
y.create.l HWIO_BIMC_M_MCDMA_MPORT_WR_WAY_CROSSING_ADDR A:0x410220
y.create.l HWIO_BIMC_M_MCDMA_MPORT_PRIORITYLVL_OVERRIDE_ADDR A:0x410230
y.create.l HWIO_BIMC_M_MCDMA_MPORT_READ_COMMAND_OVERRIDE_ADDR A:0x410240
y.create.l HWIO_BIMC_M_MCDMA_MPORT_WRITE_COMMAND_OVERRIDE_ADDR A:0x410250
y.create.l HWIO_BIMC_M_MCDMA_MPORT_RD_TRACKING_INDEX_ADDR A:0x410270
y.create.l HWIO_BIMC_M_MCDMA_MPORT_WR_TRACKING_INDEX_ADDR A:0x410274
y.create.l HWIO_BIMC_M_MCDMA_MPORT_BWMON_ENABLE_ADDR A:0x410280
y.create.l HWIO_BIMC_M_MCDMA_MPORT_BWMON_CLEAR_ADDR A:0x410284
y.create.l HWIO_BIMC_M_MCDMA_MPORT_BWMON_BYTE_COUNT_ADDR A:0x410288
y.create.l HWIO_BIMC_M_MCDMA_MPORT_BWMON_THRESHOLD_ADDR A:0x410290
y.create.l HWIO_BIMC_M_MCDMA_MPORT_BWMON_MID_MASK_ADDR A:0x410298
y.create.l HWIO_BIMC_M_MCDMA_MPORT_BWMON_MID_MATCH_ADDR A:0x41029c
y.create.l HWIO_BIMC_M_MCDMA_MPORT_BKE_ENABLE_ADDR A:0x410300
y.create.l HWIO_BIMC_M_MCDMA_MPORT_BKE_GRANT_PERIOD_ADDR A:0x410304
y.create.l HWIO_BIMC_M_MCDMA_MPORT_BKE_GRANT_COUNT_ADDR A:0x410308
y.create.l HWIO_BIMC_M_MCDMA_MPORT_BKE_THRESHOLD_HIGH_ADDR A:0x410320
y.create.l HWIO_BIMC_M_MCDMA_MPORT_BKE_THRESHOLD_MEDIUM_ADDR A:0x410324
y.create.l HWIO_BIMC_M_MCDMA_MPORT_BKE_THRESHOLD_LOW_ADDR A:0x410328
y.create.l HWIO_BIMC_M_MCDMA_MPORT_BKE_HEALTH_0_ADDR A:0x410340
y.create.l HWIO_BIMC_M_MCDMA_MPORT_BKE_HEALTH_1_ADDR A:0x410344
y.create.l HWIO_BIMC_M_MCDMA_MPORT_BKE_HEALTH_2_ADDR A:0x410348
y.create.l HWIO_BIMC_M_MCDMA_MPORT_BKE_HEALTH_3_ADDR A:0x41034c
y.create.l HWIO_BIMC_M_MCDMA_MPORT_STATUS_2A_ADDR A:0x410420
y.create.l HWIO_BIMC_M_MCDMA_MPORT_STATUS_2B_ADDR A:0x410424
y.create.l HWIO_BIMC_M_MCDMA_MPORT_STATUS_3A_ADDR A:0x410430
y.create.l HWIO_BIMC_M_MCDMA_MPORT_STATUS_3B_ADDR A:0x410434
y.create.l HWIO_BIMC_M_MCDMA_MPORT_BKE1_ENABLE_ADDR A:0x410800
y.create.l HWIO_BIMC_M_MCDMA_MPORT_BKE1_GRANT_PERIOD_ADDR A:0x410804
y.create.l HWIO_BIMC_M_MCDMA_MPORT_BKE1_GRANT_COUNT_ADDR A:0x410808
y.create.l HWIO_BIMC_M_MCDMA_MPORT_BKE1_THRESHOLD_HIGH_ADDR A:0x410820
y.create.l HWIO_BIMC_M_MCDMA_MPORT_BKE1_THRESHOLD_MEDIUM_ADDR A:0x410824
y.create.l HWIO_BIMC_M_MCDMA_MPORT_BKE1_THRESHOLD_LOW_ADDR A:0x410828
y.create.l HWIO_BIMC_M_MCDMA_MPORT_BKE1_HEALTH_0_ADDR A:0x410840
y.create.l HWIO_BIMC_M_MCDMA_MPORT_BKE1_HEALTH_1_ADDR A:0x410844
y.create.l HWIO_BIMC_M_MCDMA_MPORT_BKE1_HEALTH_2_ADDR A:0x410848
y.create.l HWIO_BIMC_M_MCDMA_MPORT_BKE1_HEALTH_3_ADDR A:0x41084c
y.create.l HWIO_BIMC_M_MCDMA_MPORT_BKE2_ENABLE_ADDR A:0x410900
y.create.l HWIO_BIMC_M_MCDMA_MPORT_BKE2_GRANT_PERIOD_ADDR A:0x410904
y.create.l HWIO_BIMC_M_MCDMA_MPORT_BKE2_GRANT_COUNT_ADDR A:0x410908
y.create.l HWIO_BIMC_M_MCDMA_MPORT_BKE2_THRESHOLD_HIGH_ADDR A:0x410920
y.create.l HWIO_BIMC_M_MCDMA_MPORT_BKE2_THRESHOLD_MEDIUM_ADDR A:0x410924
y.create.l HWIO_BIMC_M_MCDMA_MPORT_BKE2_THRESHOLD_LOW_ADDR A:0x410928
y.create.l HWIO_BIMC_M_MCDMA_MPORT_BKE2_HEALTH_0_ADDR A:0x410940
y.create.l HWIO_BIMC_M_MCDMA_MPORT_BKE2_HEALTH_1_ADDR A:0x410944
y.create.l HWIO_BIMC_M_MCDMA_MPORT_BKE2_HEALTH_2_ADDR A:0x410948
y.create.l HWIO_BIMC_M_MCDMA_MPORT_BKE2_HEALTH_3_ADDR A:0x41094c
y.create.l HWIO_BIMC_M_MCDMA_MPORT_BKE3_ENABLE_ADDR A:0x410a00
y.create.l HWIO_BIMC_M_MCDMA_MPORT_BKE3_GRANT_PERIOD_ADDR A:0x410a04
y.create.l HWIO_BIMC_M_MCDMA_MPORT_BKE3_GRANT_COUNT_ADDR A:0x410a08
y.create.l HWIO_BIMC_M_MCDMA_MPORT_BKE3_THRESHOLD_HIGH_ADDR A:0x410a20
y.create.l HWIO_BIMC_M_MCDMA_MPORT_BKE3_THRESHOLD_MEDIUM_ADDR A:0x410a24
y.create.l HWIO_BIMC_M_MCDMA_MPORT_BKE3_THRESHOLD_LOW_ADDR A:0x410a28
y.create.l HWIO_BIMC_M_MCDMA_MPORT_BKE3_HEALTH_0_ADDR A:0x410a40
y.create.l HWIO_BIMC_M_MCDMA_MPORT_BKE3_HEALTH_1_ADDR A:0x410a44
y.create.l HWIO_BIMC_M_MCDMA_MPORT_BKE3_HEALTH_2_ADDR A:0x410a48
y.create.l HWIO_BIMC_M_MCDMA_MPORT_BKE3_HEALTH_3_ADDR A:0x410a4c
y.create.l HWIO_BIMC_M_MCDMA_PROF_COMPONENT_INFO_ADDR A:0x411000
y.create.l HWIO_BIMC_M_MCDMA_PROF_CONFIGURATION_INFO_0_ADDR A:0x411020
y.create.l HWIO_BIMC_M_MCDMA_PROF_CONFIGURATION_INFO_1_ADDR A:0x411030
y.create.l HWIO_BIMC_M_MCDMA_PROF_CLOCK_CTRL_ADDR A:0x411200
y.create.l HWIO_BIMC_M_MCDMA_PROF_MODE_ADDR A:0x411210
y.create.l HWIO_BIMC_M_MCDMA_PROF_RD_TENURE_THRESHOLD_ADDR A:0x411214
y.create.l HWIO_BIMC_M_MCDMA_PROF_WR_TENURE_THRESHOLD_ADDR A:0x411218
y.create.l HWIO_BIMC_M_MCDMA_PROF_SWAY_SELECT_ADDR A:0x411220
y.create.l HWIO_BIMC_M_MCDMA_PROF_MID_MASK_ADDR A:0x411230
y.create.l HWIO_BIMC_M_MCDMA_PROF_MID_MATCH_ADDR A:0x411234
y.create.l HWIO_BIMC_M_MCDMA_PROF_MID_INV_MATCH_ADDR A:0x411238
y.create.l HWIO_BIMC_M_MCDMA_PROF_ADDR_MASK_LOWER_ADDR A:0x411240
y.create.l HWIO_BIMC_M_MCDMA_PROF_ADDR_MASK_UPPER_ADDR A:0x411244
y.create.l HWIO_BIMC_M_MCDMA_PROF_ADDR_MATCH_LOWER_ADDR A:0x411248
y.create.l HWIO_BIMC_M_MCDMA_PROF_ADDR_MATCH_UPPER_ADDR A:0x41124c
y.create.l HWIO_BIMC_M_MCDMA_PROF_ADDR_INV_MATCH_ADDR A:0x411250
y.create.l HWIO_BIMC_M_MCDMA_PROF_ACH_MASK_0_ADDR A:0x411260
y.create.l HWIO_BIMC_M_MCDMA_PROF_ACH_MATCH_0_ADDR A:0x411264
y.create.l HWIO_BIMC_M_MCDMA_PROF_ACH_MASK_1_ADDR A:0x411270
y.create.l HWIO_BIMC_M_MCDMA_PROF_ACH_MATCH_1_ADDR A:0x411274
y.create.l HWIO_BIMC_M_MCDMA_PROF_ACH_INV_MATCH_1_ADDR A:0x411278
y.create.l HWIO_BIMC_M_MCDMA_PROF_ACH_MASK_2_ADDR A:0x411280
y.create.l HWIO_BIMC_M_MCDMA_PROF_ACH_MATCH_2_ADDR A:0x411284
y.create.l HWIO_BIMC_M_MCDMA_PROF_ACH_MASK_3_ADDR A:0x411290
y.create.l HWIO_BIMC_M_MCDMA_PROF_ACH_MATCH_3_ADDR A:0x411294
y.create.l HWIO_BIMC_M_MCDMA_PROF_ACH_INV_MATCH_3_ADDR A:0x411298
y.create.l HWIO_BIMC_M_MCDMA_PROF_ACH_MASK_4_ADDR A:0x4112a0
y.create.l HWIO_BIMC_M_MCDMA_PROF_ACH_MATCH_4_ADDR A:0x4112a4
y.create.l HWIO_BIMC_M_MCDMA_PROF_ACH_INV_MATCH_4_ADDR A:0x4112a8
y.create.l HWIO_BIMC_M_MCDMA_PROF_BCH_MASK_ADDR A:0x411300
y.create.l HWIO_BIMC_M_MCDMA_PROF_BCH_MATCH_ADDR A:0x411304
y.create.l HWIO_BIMC_M_MCDMA_PROF_BCH_INV_MATCH_ADDR A:0x411308
y.create.l HWIO_BIMC_M_MCDMA_PROF_RCH_MASK_ADDR A:0x411340
y.create.l HWIO_BIMC_M_MCDMA_PROF_RCH_MATCH_ADDR A:0x411344
y.create.l HWIO_BIMC_M_MCDMA_PROF_RCH_INV_MATCH_ADDR A:0x411348
y.create.l HWIO_BIMC_M_MCDMA_PROF_RD_STATUS_0_ADDR A:0x411400
y.create.l HWIO_BIMC_M_MCDMA_PROF_WR_STATUS_0_ADDR A:0x411410
y.create.l HWIO_BIMC_M_NAV_MPORT_COMPONENT_INFO_ADDR A:0x414000
y.create.l HWIO_BIMC_M_NAV_MPORT_CONFIGURATION_INFO_0_ADDR A:0x414020
y.create.l HWIO_BIMC_M_NAV_MPORT_CONFIGURATION_INFO_1_ADDR A:0x414030
y.create.l HWIO_BIMC_M_NAV_MPORT_CONFIGURATION_INFO_2A_ADDR A:0x414040
y.create.l HWIO_BIMC_M_NAV_MPORT_CONFIGURATION_INFO_2B_ADDR A:0x414044
y.create.l HWIO_BIMC_M_NAV_MPORT_CONFIGURATION_INFO_3_ADDR A:0x414050
y.create.l HWIO_BIMC_M_NAV_MPORT_CONFIGURATION_INFO_4_ADDR A:0x414060
y.create.l HWIO_BIMC_M_NAV_MPORT_CONFIGURATION_INFO_5A_ADDR A:0x414070
y.create.l HWIO_BIMC_M_NAV_MPORT_CONFIGURATION_INFO_5B_ADDR A:0x414074
y.create.l HWIO_BIMC_M_NAV_MPORT_CONFIGURATION_INFO_5C_ADDR A:0x414078
y.create.l HWIO_BIMC_M_NAV_MPORT_CONFIGURATION_INFO_5D_ADDR A:0x41407c
y.create.l HWIO_BIMC_M_NAV_MPORT_INTERRUPT_STATUS_ADDR A:0x414100
y.create.l HWIO_BIMC_M_NAV_MPORT_INTERRUPT_CLEAR_ADDR A:0x414108
y.create.l HWIO_BIMC_M_NAV_MPORT_INTERRUPT_ENABLE_ADDR A:0x41410c
y.create.l HWIO_BIMC_M_NAV_MPORT_CLOCK_CTRL_ADDR A:0x414200
y.create.l HWIO_BIMC_M_NAV_MPORT_CDC_CTRL_ADDR A:0x414208
y.create.l HWIO_BIMC_M_NAV_MPORT_MODE_ADDR A:0x414210
y.create.l HWIO_BIMC_M_NAV_MPORT_WR_WAY_CROSSING_ADDR A:0x414220
y.create.l HWIO_BIMC_M_NAV_MPORT_PRIORITYLVL_OVERRIDE_ADDR A:0x414230
y.create.l HWIO_BIMC_M_NAV_MPORT_READ_COMMAND_OVERRIDE_ADDR A:0x414240
y.create.l HWIO_BIMC_M_NAV_MPORT_WRITE_COMMAND_OVERRIDE_ADDR A:0x414250
y.create.l HWIO_BIMC_M_NAV_MPORT_RD_TRACKING_INDEX_ADDR A:0x414270
y.create.l HWIO_BIMC_M_NAV_MPORT_WR_TRACKING_INDEX_ADDR A:0x414274
y.create.l HWIO_BIMC_M_NAV_MPORT_BWMON_ENABLE_ADDR A:0x414280
y.create.l HWIO_BIMC_M_NAV_MPORT_BWMON_CLEAR_ADDR A:0x414284
y.create.l HWIO_BIMC_M_NAV_MPORT_BWMON_BYTE_COUNT_ADDR A:0x414288
y.create.l HWIO_BIMC_M_NAV_MPORT_BWMON_THRESHOLD_ADDR A:0x414290
y.create.l HWIO_BIMC_M_NAV_MPORT_BWMON_MID_MASK_ADDR A:0x414298
y.create.l HWIO_BIMC_M_NAV_MPORT_BWMON_MID_MATCH_ADDR A:0x41429c
y.create.l HWIO_BIMC_M_NAV_MPORT_BKE_ENABLE_ADDR A:0x414300
y.create.l HWIO_BIMC_M_NAV_MPORT_BKE_GRANT_PERIOD_ADDR A:0x414304
y.create.l HWIO_BIMC_M_NAV_MPORT_BKE_GRANT_COUNT_ADDR A:0x414308
y.create.l HWIO_BIMC_M_NAV_MPORT_BKE_THRESHOLD_HIGH_ADDR A:0x414320
y.create.l HWIO_BIMC_M_NAV_MPORT_BKE_THRESHOLD_MEDIUM_ADDR A:0x414324
y.create.l HWIO_BIMC_M_NAV_MPORT_BKE_THRESHOLD_LOW_ADDR A:0x414328
y.create.l HWIO_BIMC_M_NAV_MPORT_BKE_HEALTH_0_ADDR A:0x414340
y.create.l HWIO_BIMC_M_NAV_MPORT_BKE_HEALTH_1_ADDR A:0x414344
y.create.l HWIO_BIMC_M_NAV_MPORT_BKE_HEALTH_2_ADDR A:0x414348
y.create.l HWIO_BIMC_M_NAV_MPORT_BKE_HEALTH_3_ADDR A:0x41434c
y.create.l HWIO_BIMC_M_NAV_MPORT_STATUS_2A_ADDR A:0x414420
y.create.l HWIO_BIMC_M_NAV_MPORT_STATUS_2B_ADDR A:0x414424
y.create.l HWIO_BIMC_M_NAV_MPORT_STATUS_3A_ADDR A:0x414430
y.create.l HWIO_BIMC_M_NAV_MPORT_STATUS_3B_ADDR A:0x414434
y.create.l HWIO_BIMC_M_NAV_MPORT_BKE1_ENABLE_ADDR A:0x414800
y.create.l HWIO_BIMC_M_NAV_MPORT_BKE1_GRANT_PERIOD_ADDR A:0x414804
y.create.l HWIO_BIMC_M_NAV_MPORT_BKE1_GRANT_COUNT_ADDR A:0x414808
y.create.l HWIO_BIMC_M_NAV_MPORT_BKE1_THRESHOLD_HIGH_ADDR A:0x414820
y.create.l HWIO_BIMC_M_NAV_MPORT_BKE1_THRESHOLD_MEDIUM_ADDR A:0x414824
y.create.l HWIO_BIMC_M_NAV_MPORT_BKE1_THRESHOLD_LOW_ADDR A:0x414828
y.create.l HWIO_BIMC_M_NAV_MPORT_BKE1_HEALTH_0_ADDR A:0x414840
y.create.l HWIO_BIMC_M_NAV_MPORT_BKE1_HEALTH_1_ADDR A:0x414844
y.create.l HWIO_BIMC_M_NAV_MPORT_BKE1_HEALTH_2_ADDR A:0x414848
y.create.l HWIO_BIMC_M_NAV_MPORT_BKE1_HEALTH_3_ADDR A:0x41484c
y.create.l HWIO_BIMC_M_NAV_MPORT_BKE2_ENABLE_ADDR A:0x414900
y.create.l HWIO_BIMC_M_NAV_MPORT_BKE2_GRANT_PERIOD_ADDR A:0x414904
y.create.l HWIO_BIMC_M_NAV_MPORT_BKE2_GRANT_COUNT_ADDR A:0x414908
y.create.l HWIO_BIMC_M_NAV_MPORT_BKE2_THRESHOLD_HIGH_ADDR A:0x414920
y.create.l HWIO_BIMC_M_NAV_MPORT_BKE2_THRESHOLD_MEDIUM_ADDR A:0x414924
y.create.l HWIO_BIMC_M_NAV_MPORT_BKE2_THRESHOLD_LOW_ADDR A:0x414928
y.create.l HWIO_BIMC_M_NAV_MPORT_BKE2_HEALTH_0_ADDR A:0x414940
y.create.l HWIO_BIMC_M_NAV_MPORT_BKE2_HEALTH_1_ADDR A:0x414944
y.create.l HWIO_BIMC_M_NAV_MPORT_BKE2_HEALTH_2_ADDR A:0x414948
y.create.l HWIO_BIMC_M_NAV_MPORT_BKE2_HEALTH_3_ADDR A:0x41494c
y.create.l HWIO_BIMC_M_NAV_MPORT_BKE3_ENABLE_ADDR A:0x414a00
y.create.l HWIO_BIMC_M_NAV_MPORT_BKE3_GRANT_PERIOD_ADDR A:0x414a04
y.create.l HWIO_BIMC_M_NAV_MPORT_BKE3_GRANT_COUNT_ADDR A:0x414a08
y.create.l HWIO_BIMC_M_NAV_MPORT_BKE3_THRESHOLD_HIGH_ADDR A:0x414a20
y.create.l HWIO_BIMC_M_NAV_MPORT_BKE3_THRESHOLD_MEDIUM_ADDR A:0x414a24
y.create.l HWIO_BIMC_M_NAV_MPORT_BKE3_THRESHOLD_LOW_ADDR A:0x414a28
y.create.l HWIO_BIMC_M_NAV_MPORT_BKE3_HEALTH_0_ADDR A:0x414a40
y.create.l HWIO_BIMC_M_NAV_MPORT_BKE3_HEALTH_1_ADDR A:0x414a44
y.create.l HWIO_BIMC_M_NAV_MPORT_BKE3_HEALTH_2_ADDR A:0x414a48
y.create.l HWIO_BIMC_M_NAV_MPORT_BKE3_HEALTH_3_ADDR A:0x414a4c
y.create.l HWIO_BIMC_M_NAV_PROF_COMPONENT_INFO_ADDR A:0x415000
y.create.l HWIO_BIMC_M_NAV_PROF_CONFIGURATION_INFO_0_ADDR A:0x415020
y.create.l HWIO_BIMC_M_NAV_PROF_CONFIGURATION_INFO_1_ADDR A:0x415030
y.create.l HWIO_BIMC_M_NAV_PROF_CLOCK_CTRL_ADDR A:0x415200
y.create.l HWIO_BIMC_M_NAV_PROF_MODE_ADDR A:0x415210
y.create.l HWIO_BIMC_M_NAV_PROF_RD_TENURE_THRESHOLD_ADDR A:0x415214
y.create.l HWIO_BIMC_M_NAV_PROF_WR_TENURE_THRESHOLD_ADDR A:0x415218
y.create.l HWIO_BIMC_M_NAV_PROF_SWAY_SELECT_ADDR A:0x415220
y.create.l HWIO_BIMC_M_NAV_PROF_MID_MASK_ADDR A:0x415230
y.create.l HWIO_BIMC_M_NAV_PROF_MID_MATCH_ADDR A:0x415234
y.create.l HWIO_BIMC_M_NAV_PROF_MID_INV_MATCH_ADDR A:0x415238
y.create.l HWIO_BIMC_M_NAV_PROF_ADDR_MASK_LOWER_ADDR A:0x415240
y.create.l HWIO_BIMC_M_NAV_PROF_ADDR_MASK_UPPER_ADDR A:0x415244
y.create.l HWIO_BIMC_M_NAV_PROF_ADDR_MATCH_LOWER_ADDR A:0x415248
y.create.l HWIO_BIMC_M_NAV_PROF_ADDR_MATCH_UPPER_ADDR A:0x41524c
y.create.l HWIO_BIMC_M_NAV_PROF_ADDR_INV_MATCH_ADDR A:0x415250
y.create.l HWIO_BIMC_M_NAV_PROF_ACH_MASK_0_ADDR A:0x415260
y.create.l HWIO_BIMC_M_NAV_PROF_ACH_MATCH_0_ADDR A:0x415264
y.create.l HWIO_BIMC_M_NAV_PROF_ACH_MASK_1_ADDR A:0x415270
y.create.l HWIO_BIMC_M_NAV_PROF_ACH_MATCH_1_ADDR A:0x415274
y.create.l HWIO_BIMC_M_NAV_PROF_ACH_INV_MATCH_1_ADDR A:0x415278
y.create.l HWIO_BIMC_M_NAV_PROF_ACH_MASK_2_ADDR A:0x415280
y.create.l HWIO_BIMC_M_NAV_PROF_ACH_MATCH_2_ADDR A:0x415284
y.create.l HWIO_BIMC_M_NAV_PROF_ACH_MASK_3_ADDR A:0x415290
y.create.l HWIO_BIMC_M_NAV_PROF_ACH_MATCH_3_ADDR A:0x415294
y.create.l HWIO_BIMC_M_NAV_PROF_ACH_INV_MATCH_3_ADDR A:0x415298
y.create.l HWIO_BIMC_M_NAV_PROF_ACH_MASK_4_ADDR A:0x4152a0
y.create.l HWIO_BIMC_M_NAV_PROF_ACH_MATCH_4_ADDR A:0x4152a4
y.create.l HWIO_BIMC_M_NAV_PROF_ACH_INV_MATCH_4_ADDR A:0x4152a8
y.create.l HWIO_BIMC_M_NAV_PROF_BCH_MASK_ADDR A:0x415300
y.create.l HWIO_BIMC_M_NAV_PROF_BCH_MATCH_ADDR A:0x415304
y.create.l HWIO_BIMC_M_NAV_PROF_BCH_INV_MATCH_ADDR A:0x415308
y.create.l HWIO_BIMC_M_NAV_PROF_RCH_MASK_ADDR A:0x415340
y.create.l HWIO_BIMC_M_NAV_PROF_RCH_MATCH_ADDR A:0x415344
y.create.l HWIO_BIMC_M_NAV_PROF_RCH_INV_MATCH_ADDR A:0x415348
y.create.l HWIO_BIMC_M_NAV_PROF_RD_STATUS_0_ADDR A:0x415400
y.create.l HWIO_BIMC_M_NAV_PROF_WR_STATUS_0_ADDR A:0x415410
y.create.l HWIO_BIMC_M_SYS_MPORT_COMPONENT_INFO_ADDR A:0x418000
y.create.l HWIO_BIMC_M_SYS_MPORT_CONFIGURATION_INFO_0_ADDR A:0x418020
y.create.l HWIO_BIMC_M_SYS_MPORT_CONFIGURATION_INFO_1_ADDR A:0x418030
y.create.l HWIO_BIMC_M_SYS_MPORT_CONFIGURATION_INFO_2A_ADDR A:0x418040
y.create.l HWIO_BIMC_M_SYS_MPORT_CONFIGURATION_INFO_2B_ADDR A:0x418044
y.create.l HWIO_BIMC_M_SYS_MPORT_CONFIGURATION_INFO_3_ADDR A:0x418050
y.create.l HWIO_BIMC_M_SYS_MPORT_CONFIGURATION_INFO_4_ADDR A:0x418060
y.create.l HWIO_BIMC_M_SYS_MPORT_CONFIGURATION_INFO_5A_ADDR A:0x418070
y.create.l HWIO_BIMC_M_SYS_MPORT_CONFIGURATION_INFO_5B_ADDR A:0x418074
y.create.l HWIO_BIMC_M_SYS_MPORT_CONFIGURATION_INFO_5C_ADDR A:0x418078
y.create.l HWIO_BIMC_M_SYS_MPORT_CONFIGURATION_INFO_5D_ADDR A:0x41807c
y.create.l HWIO_BIMC_M_SYS_MPORT_INTERRUPT_STATUS_ADDR A:0x418100
y.create.l HWIO_BIMC_M_SYS_MPORT_INTERRUPT_CLEAR_ADDR A:0x418108
y.create.l HWIO_BIMC_M_SYS_MPORT_INTERRUPT_ENABLE_ADDR A:0x41810c
y.create.l HWIO_BIMC_M_SYS_MPORT_CLOCK_CTRL_ADDR A:0x418200
y.create.l HWIO_BIMC_M_SYS_MPORT_CDC_CTRL_ADDR A:0x418208
y.create.l HWIO_BIMC_M_SYS_MPORT_MODE_ADDR A:0x418210
y.create.l HWIO_BIMC_M_SYS_MPORT_WR_WAY_CROSSING_ADDR A:0x418220
y.create.l HWIO_BIMC_M_SYS_MPORT_PRIORITYLVL_OVERRIDE_ADDR A:0x418230
y.create.l HWIO_BIMC_M_SYS_MPORT_READ_COMMAND_OVERRIDE_ADDR A:0x418240
y.create.l HWIO_BIMC_M_SYS_MPORT_WRITE_COMMAND_OVERRIDE_ADDR A:0x418250
y.create.l HWIO_BIMC_M_SYS_MPORT_RD_TRACKING_INDEX_ADDR A:0x418270
y.create.l HWIO_BIMC_M_SYS_MPORT_WR_TRACKING_INDEX_ADDR A:0x418274
y.create.l HWIO_BIMC_M_SYS_MPORT_BWMON_ENABLE_ADDR A:0x418280
y.create.l HWIO_BIMC_M_SYS_MPORT_BWMON_CLEAR_ADDR A:0x418284
y.create.l HWIO_BIMC_M_SYS_MPORT_BWMON_BYTE_COUNT_ADDR A:0x418288
y.create.l HWIO_BIMC_M_SYS_MPORT_BWMON_THRESHOLD_ADDR A:0x418290
y.create.l HWIO_BIMC_M_SYS_MPORT_BWMON_MID_MASK_ADDR A:0x418298
y.create.l HWIO_BIMC_M_SYS_MPORT_BWMON_MID_MATCH_ADDR A:0x41829c
y.create.l HWIO_BIMC_M_SYS_MPORT_BKE_ENABLE_ADDR A:0x418300
y.create.l HWIO_BIMC_M_SYS_MPORT_BKE_GRANT_PERIOD_ADDR A:0x418304
y.create.l HWIO_BIMC_M_SYS_MPORT_BKE_GRANT_COUNT_ADDR A:0x418308
y.create.l HWIO_BIMC_M_SYS_MPORT_BKE_THRESHOLD_HIGH_ADDR A:0x418320
y.create.l HWIO_BIMC_M_SYS_MPORT_BKE_THRESHOLD_MEDIUM_ADDR A:0x418324
y.create.l HWIO_BIMC_M_SYS_MPORT_BKE_THRESHOLD_LOW_ADDR A:0x418328
y.create.l HWIO_BIMC_M_SYS_MPORT_BKE_HEALTH_0_ADDR A:0x418340
y.create.l HWIO_BIMC_M_SYS_MPORT_BKE_HEALTH_1_ADDR A:0x418344
y.create.l HWIO_BIMC_M_SYS_MPORT_BKE_HEALTH_2_ADDR A:0x418348
y.create.l HWIO_BIMC_M_SYS_MPORT_BKE_HEALTH_3_ADDR A:0x41834c
y.create.l HWIO_BIMC_M_SYS_MPORT_STATUS_2A_ADDR A:0x418420
y.create.l HWIO_BIMC_M_SYS_MPORT_STATUS_2B_ADDR A:0x418424
y.create.l HWIO_BIMC_M_SYS_MPORT_STATUS_3A_ADDR A:0x418430
y.create.l HWIO_BIMC_M_SYS_MPORT_STATUS_3B_ADDR A:0x418434
y.create.l HWIO_BIMC_M_SYS_MPORT_BKE1_ENABLE_ADDR A:0x418800
y.create.l HWIO_BIMC_M_SYS_MPORT_BKE1_GRANT_PERIOD_ADDR A:0x418804
y.create.l HWIO_BIMC_M_SYS_MPORT_BKE1_GRANT_COUNT_ADDR A:0x418808
y.create.l HWIO_BIMC_M_SYS_MPORT_BKE1_THRESHOLD_HIGH_ADDR A:0x418820
y.create.l HWIO_BIMC_M_SYS_MPORT_BKE1_THRESHOLD_MEDIUM_ADDR A:0x418824
y.create.l HWIO_BIMC_M_SYS_MPORT_BKE1_THRESHOLD_LOW_ADDR A:0x418828
y.create.l HWIO_BIMC_M_SYS_MPORT_BKE1_HEALTH_0_ADDR A:0x418840
y.create.l HWIO_BIMC_M_SYS_MPORT_BKE1_HEALTH_1_ADDR A:0x418844
y.create.l HWIO_BIMC_M_SYS_MPORT_BKE1_HEALTH_2_ADDR A:0x418848
y.create.l HWIO_BIMC_M_SYS_MPORT_BKE1_HEALTH_3_ADDR A:0x41884c
y.create.l HWIO_BIMC_M_SYS_MPORT_BKE2_ENABLE_ADDR A:0x418900
y.create.l HWIO_BIMC_M_SYS_MPORT_BKE2_GRANT_PERIOD_ADDR A:0x418904
y.create.l HWIO_BIMC_M_SYS_MPORT_BKE2_GRANT_COUNT_ADDR A:0x418908
y.create.l HWIO_BIMC_M_SYS_MPORT_BKE2_THRESHOLD_HIGH_ADDR A:0x418920
y.create.l HWIO_BIMC_M_SYS_MPORT_BKE2_THRESHOLD_MEDIUM_ADDR A:0x418924
y.create.l HWIO_BIMC_M_SYS_MPORT_BKE2_THRESHOLD_LOW_ADDR A:0x418928
y.create.l HWIO_BIMC_M_SYS_MPORT_BKE2_HEALTH_0_ADDR A:0x418940
y.create.l HWIO_BIMC_M_SYS_MPORT_BKE2_HEALTH_1_ADDR A:0x418944
y.create.l HWIO_BIMC_M_SYS_MPORT_BKE2_HEALTH_2_ADDR A:0x418948
y.create.l HWIO_BIMC_M_SYS_MPORT_BKE2_HEALTH_3_ADDR A:0x41894c
y.create.l HWIO_BIMC_M_SYS_MPORT_BKE3_ENABLE_ADDR A:0x418a00
y.create.l HWIO_BIMC_M_SYS_MPORT_BKE3_GRANT_PERIOD_ADDR A:0x418a04
y.create.l HWIO_BIMC_M_SYS_MPORT_BKE3_GRANT_COUNT_ADDR A:0x418a08
y.create.l HWIO_BIMC_M_SYS_MPORT_BKE3_THRESHOLD_HIGH_ADDR A:0x418a20
y.create.l HWIO_BIMC_M_SYS_MPORT_BKE3_THRESHOLD_MEDIUM_ADDR A:0x418a24
y.create.l HWIO_BIMC_M_SYS_MPORT_BKE3_THRESHOLD_LOW_ADDR A:0x418a28
y.create.l HWIO_BIMC_M_SYS_MPORT_BKE3_HEALTH_0_ADDR A:0x418a40
y.create.l HWIO_BIMC_M_SYS_MPORT_BKE3_HEALTH_1_ADDR A:0x418a44
y.create.l HWIO_BIMC_M_SYS_MPORT_BKE3_HEALTH_2_ADDR A:0x418a48
y.create.l HWIO_BIMC_M_SYS_MPORT_BKE3_HEALTH_3_ADDR A:0x418a4c
y.create.l HWIO_BIMC_M_SYS_PROF_COMPONENT_INFO_ADDR A:0x419000
y.create.l HWIO_BIMC_M_SYS_PROF_CONFIGURATION_INFO_0_ADDR A:0x419020
y.create.l HWIO_BIMC_M_SYS_PROF_CONFIGURATION_INFO_1_ADDR A:0x419030
y.create.l HWIO_BIMC_M_SYS_PROF_CLOCK_CTRL_ADDR A:0x419200
y.create.l HWIO_BIMC_M_SYS_PROF_MODE_ADDR A:0x419210
y.create.l HWIO_BIMC_M_SYS_PROF_RD_TENURE_THRESHOLD_ADDR A:0x419214
y.create.l HWIO_BIMC_M_SYS_PROF_WR_TENURE_THRESHOLD_ADDR A:0x419218
y.create.l HWIO_BIMC_M_SYS_PROF_SWAY_SELECT_ADDR A:0x419220
y.create.l HWIO_BIMC_M_SYS_PROF_MID_MASK_ADDR A:0x419230
y.create.l HWIO_BIMC_M_SYS_PROF_MID_MATCH_ADDR A:0x419234
y.create.l HWIO_BIMC_M_SYS_PROF_MID_INV_MATCH_ADDR A:0x419238
y.create.l HWIO_BIMC_M_SYS_PROF_ADDR_MASK_LOWER_ADDR A:0x419240
y.create.l HWIO_BIMC_M_SYS_PROF_ADDR_MASK_UPPER_ADDR A:0x419244
y.create.l HWIO_BIMC_M_SYS_PROF_ADDR_MATCH_LOWER_ADDR A:0x419248
y.create.l HWIO_BIMC_M_SYS_PROF_ADDR_MATCH_UPPER_ADDR A:0x41924c
y.create.l HWIO_BIMC_M_SYS_PROF_ADDR_INV_MATCH_ADDR A:0x419250
y.create.l HWIO_BIMC_M_SYS_PROF_ACH_MASK_0_ADDR A:0x419260
y.create.l HWIO_BIMC_M_SYS_PROF_ACH_MATCH_0_ADDR A:0x419264
y.create.l HWIO_BIMC_M_SYS_PROF_ACH_MASK_1_ADDR A:0x419270
y.create.l HWIO_BIMC_M_SYS_PROF_ACH_MATCH_1_ADDR A:0x419274
y.create.l HWIO_BIMC_M_SYS_PROF_ACH_INV_MATCH_1_ADDR A:0x419278
y.create.l HWIO_BIMC_M_SYS_PROF_ACH_MASK_2_ADDR A:0x419280
y.create.l HWIO_BIMC_M_SYS_PROF_ACH_MATCH_2_ADDR A:0x419284
y.create.l HWIO_BIMC_M_SYS_PROF_ACH_MASK_3_ADDR A:0x419290
y.create.l HWIO_BIMC_M_SYS_PROF_ACH_MATCH_3_ADDR A:0x419294
y.create.l HWIO_BIMC_M_SYS_PROF_ACH_INV_MATCH_3_ADDR A:0x419298
y.create.l HWIO_BIMC_M_SYS_PROF_ACH_MASK_4_ADDR A:0x4192a0
y.create.l HWIO_BIMC_M_SYS_PROF_ACH_MATCH_4_ADDR A:0x4192a4
y.create.l HWIO_BIMC_M_SYS_PROF_ACH_INV_MATCH_4_ADDR A:0x4192a8
y.create.l HWIO_BIMC_M_SYS_PROF_BCH_MASK_ADDR A:0x419300
y.create.l HWIO_BIMC_M_SYS_PROF_BCH_MATCH_ADDR A:0x419304
y.create.l HWIO_BIMC_M_SYS_PROF_BCH_INV_MATCH_ADDR A:0x419308
y.create.l HWIO_BIMC_M_SYS_PROF_RCH_MASK_ADDR A:0x419340
y.create.l HWIO_BIMC_M_SYS_PROF_RCH_MATCH_ADDR A:0x419344
y.create.l HWIO_BIMC_M_SYS_PROF_RCH_INV_MATCH_ADDR A:0x419348
y.create.l HWIO_BIMC_M_SYS_PROF_RD_STATUS_0_ADDR A:0x419400
y.create.l HWIO_BIMC_M_SYS_PROF_WR_STATUS_0_ADDR A:0x419410
y.create.l HWIO_BIMC_M_TCU_MPORT_COMPONENT_INFO_ADDR A:0x41c000
y.create.l HWIO_BIMC_M_TCU_MPORT_CONFIGURATION_INFO_0_ADDR A:0x41c020
y.create.l HWIO_BIMC_M_TCU_MPORT_CONFIGURATION_INFO_1_ADDR A:0x41c030
y.create.l HWIO_BIMC_M_TCU_MPORT_CONFIGURATION_INFO_2A_ADDR A:0x41c040
y.create.l HWIO_BIMC_M_TCU_MPORT_CONFIGURATION_INFO_2B_ADDR A:0x41c044
y.create.l HWIO_BIMC_M_TCU_MPORT_CONFIGURATION_INFO_3_ADDR A:0x41c050
y.create.l HWIO_BIMC_M_TCU_MPORT_CONFIGURATION_INFO_4_ADDR A:0x41c060
y.create.l HWIO_BIMC_M_TCU_MPORT_CONFIGURATION_INFO_5A_ADDR A:0x41c070
y.create.l HWIO_BIMC_M_TCU_MPORT_CONFIGURATION_INFO_5B_ADDR A:0x41c074
y.create.l HWIO_BIMC_M_TCU_MPORT_CONFIGURATION_INFO_5C_ADDR A:0x41c078
y.create.l HWIO_BIMC_M_TCU_MPORT_CONFIGURATION_INFO_5D_ADDR A:0x41c07c
y.create.l HWIO_BIMC_M_TCU_MPORT_INTERRUPT_STATUS_ADDR A:0x41c100
y.create.l HWIO_BIMC_M_TCU_MPORT_INTERRUPT_CLEAR_ADDR A:0x41c108
y.create.l HWIO_BIMC_M_TCU_MPORT_INTERRUPT_ENABLE_ADDR A:0x41c10c
y.create.l HWIO_BIMC_M_TCU_MPORT_CLOCK_CTRL_ADDR A:0x41c200
y.create.l HWIO_BIMC_M_TCU_MPORT_CDC_CTRL_ADDR A:0x41c208
y.create.l HWIO_BIMC_M_TCU_MPORT_MODE_ADDR A:0x41c210
y.create.l HWIO_BIMC_M_TCU_MPORT_WR_WAY_CROSSING_ADDR A:0x41c220
y.create.l HWIO_BIMC_M_TCU_MPORT_PRIORITYLVL_OVERRIDE_ADDR A:0x41c230
y.create.l HWIO_BIMC_M_TCU_MPORT_READ_COMMAND_OVERRIDE_ADDR A:0x41c240
y.create.l HWIO_BIMC_M_TCU_MPORT_WRITE_COMMAND_OVERRIDE_ADDR A:0x41c250
y.create.l HWIO_BIMC_M_TCU_MPORT_RD_TRACKING_INDEX_ADDR A:0x41c270
y.create.l HWIO_BIMC_M_TCU_MPORT_WR_TRACKING_INDEX_ADDR A:0x41c274
y.create.l HWIO_BIMC_M_TCU_MPORT_BWMON_ENABLE_ADDR A:0x41c280
y.create.l HWIO_BIMC_M_TCU_MPORT_BWMON_CLEAR_ADDR A:0x41c284
y.create.l HWIO_BIMC_M_TCU_MPORT_BWMON_BYTE_COUNT_ADDR A:0x41c288
y.create.l HWIO_BIMC_M_TCU_MPORT_BWMON_THRESHOLD_ADDR A:0x41c290
y.create.l HWIO_BIMC_M_TCU_MPORT_BWMON_MID_MASK_ADDR A:0x41c298
y.create.l HWIO_BIMC_M_TCU_MPORT_BWMON_MID_MATCH_ADDR A:0x41c29c
y.create.l HWIO_BIMC_M_TCU_MPORT_BKE_ENABLE_ADDR A:0x41c300
y.create.l HWIO_BIMC_M_TCU_MPORT_BKE_GRANT_PERIOD_ADDR A:0x41c304
y.create.l HWIO_BIMC_M_TCU_MPORT_BKE_GRANT_COUNT_ADDR A:0x41c308
y.create.l HWIO_BIMC_M_TCU_MPORT_BKE_THRESHOLD_HIGH_ADDR A:0x41c320
y.create.l HWIO_BIMC_M_TCU_MPORT_BKE_THRESHOLD_MEDIUM_ADDR A:0x41c324
y.create.l HWIO_BIMC_M_TCU_MPORT_BKE_THRESHOLD_LOW_ADDR A:0x41c328
y.create.l HWIO_BIMC_M_TCU_MPORT_BKE_HEALTH_0_ADDR A:0x41c340
y.create.l HWIO_BIMC_M_TCU_MPORT_BKE_HEALTH_1_ADDR A:0x41c344
y.create.l HWIO_BIMC_M_TCU_MPORT_BKE_HEALTH_2_ADDR A:0x41c348
y.create.l HWIO_BIMC_M_TCU_MPORT_BKE_HEALTH_3_ADDR A:0x41c34c
y.create.l HWIO_BIMC_M_TCU_MPORT_STATUS_2A_ADDR A:0x41c420
y.create.l HWIO_BIMC_M_TCU_MPORT_STATUS_2B_ADDR A:0x41c424
y.create.l HWIO_BIMC_M_TCU_MPORT_STATUS_3A_ADDR A:0x41c430
y.create.l HWIO_BIMC_M_TCU_MPORT_STATUS_3B_ADDR A:0x41c434
y.create.l HWIO_BIMC_M_TCU_MPORT_BKE1_ENABLE_ADDR A:0x41c800
y.create.l HWIO_BIMC_M_TCU_MPORT_BKE1_GRANT_PERIOD_ADDR A:0x41c804
y.create.l HWIO_BIMC_M_TCU_MPORT_BKE1_GRANT_COUNT_ADDR A:0x41c808
y.create.l HWIO_BIMC_M_TCU_MPORT_BKE1_THRESHOLD_HIGH_ADDR A:0x41c820
y.create.l HWIO_BIMC_M_TCU_MPORT_BKE1_THRESHOLD_MEDIUM_ADDR A:0x41c824
y.create.l HWIO_BIMC_M_TCU_MPORT_BKE1_THRESHOLD_LOW_ADDR A:0x41c828
y.create.l HWIO_BIMC_M_TCU_MPORT_BKE1_HEALTH_0_ADDR A:0x41c840
y.create.l HWIO_BIMC_M_TCU_MPORT_BKE1_HEALTH_1_ADDR A:0x41c844
y.create.l HWIO_BIMC_M_TCU_MPORT_BKE1_HEALTH_2_ADDR A:0x41c848
y.create.l HWIO_BIMC_M_TCU_MPORT_BKE1_HEALTH_3_ADDR A:0x41c84c
y.create.l HWIO_BIMC_M_TCU_MPORT_BKE2_ENABLE_ADDR A:0x41c900
y.create.l HWIO_BIMC_M_TCU_MPORT_BKE2_GRANT_PERIOD_ADDR A:0x41c904
y.create.l HWIO_BIMC_M_TCU_MPORT_BKE2_GRANT_COUNT_ADDR A:0x41c908
y.create.l HWIO_BIMC_M_TCU_MPORT_BKE2_THRESHOLD_HIGH_ADDR A:0x41c920
y.create.l HWIO_BIMC_M_TCU_MPORT_BKE2_THRESHOLD_MEDIUM_ADDR A:0x41c924
y.create.l HWIO_BIMC_M_TCU_MPORT_BKE2_THRESHOLD_LOW_ADDR A:0x41c928
y.create.l HWIO_BIMC_M_TCU_MPORT_BKE2_HEALTH_0_ADDR A:0x41c940
y.create.l HWIO_BIMC_M_TCU_MPORT_BKE2_HEALTH_1_ADDR A:0x41c944
y.create.l HWIO_BIMC_M_TCU_MPORT_BKE2_HEALTH_2_ADDR A:0x41c948
y.create.l HWIO_BIMC_M_TCU_MPORT_BKE2_HEALTH_3_ADDR A:0x41c94c
y.create.l HWIO_BIMC_M_TCU_MPORT_BKE3_ENABLE_ADDR A:0x41ca00
y.create.l HWIO_BIMC_M_TCU_MPORT_BKE3_GRANT_PERIOD_ADDR A:0x41ca04
y.create.l HWIO_BIMC_M_TCU_MPORT_BKE3_GRANT_COUNT_ADDR A:0x41ca08
y.create.l HWIO_BIMC_M_TCU_MPORT_BKE3_THRESHOLD_HIGH_ADDR A:0x41ca20
y.create.l HWIO_BIMC_M_TCU_MPORT_BKE3_THRESHOLD_MEDIUM_ADDR A:0x41ca24
y.create.l HWIO_BIMC_M_TCU_MPORT_BKE3_THRESHOLD_LOW_ADDR A:0x41ca28
y.create.l HWIO_BIMC_M_TCU_MPORT_BKE3_HEALTH_0_ADDR A:0x41ca40
y.create.l HWIO_BIMC_M_TCU_MPORT_BKE3_HEALTH_1_ADDR A:0x41ca44
y.create.l HWIO_BIMC_M_TCU_MPORT_BKE3_HEALTH_2_ADDR A:0x41ca48
y.create.l HWIO_BIMC_M_TCU_MPORT_BKE3_HEALTH_3_ADDR A:0x41ca4c
y.create.l HWIO_BIMC_M_TCU_PROF_COMPONENT_INFO_ADDR A:0x41d000
y.create.l HWIO_BIMC_M_TCU_PROF_CONFIGURATION_INFO_0_ADDR A:0x41d020
y.create.l HWIO_BIMC_M_TCU_PROF_CONFIGURATION_INFO_1_ADDR A:0x41d030
y.create.l HWIO_BIMC_M_TCU_PROF_CLOCK_CTRL_ADDR A:0x41d200
y.create.l HWIO_BIMC_M_TCU_PROF_MODE_ADDR A:0x41d210
y.create.l HWIO_BIMC_M_TCU_PROF_RD_TENURE_THRESHOLD_ADDR A:0x41d214
y.create.l HWIO_BIMC_M_TCU_PROF_WR_TENURE_THRESHOLD_ADDR A:0x41d218
y.create.l HWIO_BIMC_M_TCU_PROF_SWAY_SELECT_ADDR A:0x41d220
y.create.l HWIO_BIMC_M_TCU_PROF_MID_MASK_ADDR A:0x41d230
y.create.l HWIO_BIMC_M_TCU_PROF_MID_MATCH_ADDR A:0x41d234
y.create.l HWIO_BIMC_M_TCU_PROF_MID_INV_MATCH_ADDR A:0x41d238
y.create.l HWIO_BIMC_M_TCU_PROF_ADDR_MASK_LOWER_ADDR A:0x41d240
y.create.l HWIO_BIMC_M_TCU_PROF_ADDR_MASK_UPPER_ADDR A:0x41d244
y.create.l HWIO_BIMC_M_TCU_PROF_ADDR_MATCH_LOWER_ADDR A:0x41d248
y.create.l HWIO_BIMC_M_TCU_PROF_ADDR_MATCH_UPPER_ADDR A:0x41d24c
y.create.l HWIO_BIMC_M_TCU_PROF_ADDR_INV_MATCH_ADDR A:0x41d250
y.create.l HWIO_BIMC_M_TCU_PROF_ACH_MASK_0_ADDR A:0x41d260
y.create.l HWIO_BIMC_M_TCU_PROF_ACH_MATCH_0_ADDR A:0x41d264
y.create.l HWIO_BIMC_M_TCU_PROF_ACH_MASK_1_ADDR A:0x41d270
y.create.l HWIO_BIMC_M_TCU_PROF_ACH_MATCH_1_ADDR A:0x41d274
y.create.l HWIO_BIMC_M_TCU_PROF_ACH_INV_MATCH_1_ADDR A:0x41d278
y.create.l HWIO_BIMC_M_TCU_PROF_ACH_MASK_2_ADDR A:0x41d280
y.create.l HWIO_BIMC_M_TCU_PROF_ACH_MATCH_2_ADDR A:0x41d284
y.create.l HWIO_BIMC_M_TCU_PROF_ACH_MASK_3_ADDR A:0x41d290
y.create.l HWIO_BIMC_M_TCU_PROF_ACH_MATCH_3_ADDR A:0x41d294
y.create.l HWIO_BIMC_M_TCU_PROF_ACH_INV_MATCH_3_ADDR A:0x41d298
y.create.l HWIO_BIMC_M_TCU_PROF_ACH_MASK_4_ADDR A:0x41d2a0
y.create.l HWIO_BIMC_M_TCU_PROF_ACH_MATCH_4_ADDR A:0x41d2a4
y.create.l HWIO_BIMC_M_TCU_PROF_ACH_INV_MATCH_4_ADDR A:0x41d2a8
y.create.l HWIO_BIMC_M_TCU_PROF_BCH_MASK_ADDR A:0x41d300
y.create.l HWIO_BIMC_M_TCU_PROF_BCH_MATCH_ADDR A:0x41d304
y.create.l HWIO_BIMC_M_TCU_PROF_BCH_INV_MATCH_ADDR A:0x41d308
y.create.l HWIO_BIMC_M_TCU_PROF_RCH_MASK_ADDR A:0x41d340
y.create.l HWIO_BIMC_M_TCU_PROF_RCH_MATCH_ADDR A:0x41d344
y.create.l HWIO_BIMC_M_TCU_PROF_RCH_INV_MATCH_ADDR A:0x41d348
y.create.l HWIO_BIMC_M_TCU_PROF_RD_STATUS_0_ADDR A:0x41d400
y.create.l HWIO_BIMC_M_TCU_PROF_WR_STATUS_0_ADDR A:0x41d410
y.create.l HWIO_BIMC_S_SYS_SWAY_COMPONENT_INFO_ADDR A:0x450000
y.create.l HWIO_BIMC_S_SYS_SWAY_CONFIGURATION_INFO_0_ADDR A:0x450020
y.create.l HWIO_BIMC_S_SYS_SWAY_CONFIGURATION_INFO_1_ADDR A:0x450030
y.create.l HWIO_BIMC_S_SYS_SWAY_CONFIGURATION_INFO_2_ADDR A:0x450040
y.create.l HWIO_BIMC_S_SYS_SWAY_CONFIGURATION_INFO_3_ADDR A:0x450050
y.create.l HWIO_BIMC_S_SYS_SWAY_CONFIGURATION_INFO_4_ADDR A:0x450060
y.create.l HWIO_BIMC_S_SYS_SWAY_CONFIGURATION_INFO_5_ADDR A:0x450070
y.create.l HWIO_BIMC_S_SYS_SWAY_CONFIGURATION_INFO_6A_ADDR A:0x450080
y.create.l HWIO_BIMC_S_SYS_SWAY_CONFIGURATION_INFO_6B_ADDR A:0x450084
y.create.l HWIO_BIMC_S_SYS_SWAY_CONFIGURATION_INFO_6C_ADDR A:0x450088
y.create.l HWIO_BIMC_S_SYS_SWAY_CONFIGURATION_INFO_6D_ADDR A:0x45008c
y.create.l HWIO_BIMC_S_SYS_SWAY_INTERRUPT_STATUS_ADDR A:0x450100
y.create.l HWIO_BIMC_S_SYS_SWAY_INTERRUPT_CLEAR_ADDR A:0x450108
y.create.l HWIO_BIMC_S_SYS_SWAY_INTERRUPT_ENABLE_ADDR A:0x45010c
y.create.l HWIO_BIMC_S_SYS_SWAY_CLOCK_CTRL_ADDR A:0x450200
y.create.l HWIO_BIMC_S_SYS_SWAY_CDC_CTRL_ADDR A:0x450208
y.create.l HWIO_BIMC_S_SYS_SWAY_RCH_SELECT_ADDR A:0x450210
y.create.l HWIO_BIMC_S_SYS_SWAY_MAX_OUTSTANDING_REQUESTS_ADDR A:0x450220
y.create.l HWIO_BIMC_S_SYS_SWAY_GATHERING_ADDR A:0x450230
y.create.l HWIO_BIMC_S_SYS_SWAY_MODE_ADDR A:0x450240
y.create.l HWIO_BIMC_S_SYS_SWAY_READ_COMMAND_OVERRIDE_ADDR A:0x450250
y.create.l HWIO_BIMC_S_SYS_SWAY_WRITE_COMMAND_OVERRIDE_ADDR A:0x450260
y.create.l HWIO_BIMC_S_SYS_SWAY_STATUS_0A_ADDR A:0x450400
y.create.l HWIO_BIMC_S_SYS_SWAY_STATUS_0B_ADDR A:0x450404
y.create.l HWIO_BIMC_S_SYS_SWAY_STATUS_0C_ADDR A:0x450408
y.create.l HWIO_BIMC_S_SYS_SWAY_STATUS_0D_ADDR A:0x45040c
y.create.l HWIO_BIMC_S_SYS_SWAY_STATUS_1A_ADDR A:0x450410
y.create.l HWIO_BIMC_S_SYS_SWAY_STATUS_1B_ADDR A:0x450414
y.create.l HWIO_BIMC_S_SYS_SWAY_STATUS_1C_ADDR A:0x450418
y.create.l HWIO_BIMC_S_DEFAULT_SWAY_COMPONENT_INFO_ADDR A:0x458000
y.create.l HWIO_BIMC_S_DEFAULT_SWAY_CONFIGURATION_INFO_0_ADDR A:0x458020
y.create.l HWIO_BIMC_S_DEFAULT_SWAY_CONFIGURATION_INFO_1_ADDR A:0x458030
y.create.l HWIO_BIMC_S_DEFAULT_SWAY_INTERRUPT_STATUS_ADDR A:0x458100
y.create.l HWIO_BIMC_S_DEFAULT_SWAY_INTERRUPT_CLEAR_ADDR A:0x458108
y.create.l HWIO_BIMC_S_DEFAULT_SWAY_INTERRUPT_ENABLE_ADDR A:0x45810c
y.create.l HWIO_BIMC_S_DEFAULT_SWAY_DEFAULT_SLAVE_STATUS_0_ADDR A:0x458400
y.create.l HWIO_BIMC_S_DEFAULT_SWAY_DEFAULT_SLAVE_STATUS_1_ADDR A:0x458410
y.create.l HWIO_BIMC_S_DEFAULT_SWAY_DEFAULT_SLAVE_STATUS_2_ADDR A:0x458420
y.create.l HWIO_BIMC_S_DDR0_ARB_COMPONENT_INFO_ADDR A:0x449000
y.create.l HWIO_BIMC_S_DDR0_ARB_CONFIGURATION_INFO_0_ADDR A:0x449020
y.create.l HWIO_BIMC_S_DDR0_ARB_CONFIGURATION_INFO_1_ADDR A:0x449030
y.create.l HWIO_BIMC_S_DDR0_ARB_CLOCK_CTRL_ADDR A:0x449200
y.create.l HWIO_BIMC_S_DDR0_ARB_MODE_ADDR A:0x449210
y.create.l HWIO_BIMC_S_DDR0_ARB_MASTER0_GRANTS_ADDR A:0x449220
y.create.l HWIO_BIMC_S_DDR0_ARB_MASTER1_GRANTS_ADDR A:0x449224
y.create.l HWIO_BIMC_S_DDR0_ARB_MASTER2_GRANTS_ADDR A:0x449228
y.create.l HWIO_BIMC_S_DDR0_ARB_MASTER3_GRANTS_ADDR A:0x44922c
y.create.l HWIO_BIMC_S_DDR0_ARB_MASTER4_GRANTS_ADDR A:0x449230
y.create.l HWIO_BIMC_S_DDR0_ARB_MASTER5_GRANTS_ADDR A:0x449234
y.create.l HWIO_BIMC_S_SYS_ARB_COMPONENT_INFO_ADDR A:0x451000
y.create.l HWIO_BIMC_S_SYS_ARB_CONFIGURATION_INFO_0_ADDR A:0x451020
y.create.l HWIO_BIMC_S_SYS_ARB_CONFIGURATION_INFO_1_ADDR A:0x451030
y.create.l HWIO_BIMC_S_SYS_ARB_CLOCK_CTRL_ADDR A:0x451200
y.create.l HWIO_BIMC_S_SYS_ARB_MODE_ADDR A:0x451210
y.create.l HWIO_BIMC_S_DEFAULT_ARB_COMPONENT_INFO_ADDR A:0x459000
y.create.l HWIO_BIMC_S_DEFAULT_ARB_CONFIGURATION_INFO_0_ADDR A:0x459020
y.create.l HWIO_BIMC_S_DEFAULT_ARB_CONFIGURATION_INFO_1_ADDR A:0x459030
y.create.l HWIO_BIMC_S_DEFAULT_ARB_CLOCK_CTRL_ADDR A:0x459200
y.create.l HWIO_BIMC_S_DEFAULT_ARB_MODE_ADDR A:0x459210
y.create.l HWIO_BIMC_S_DDR0_SCMO_COMPONENT_INFO_ADDR A:0x448000
y.create.l HWIO_BIMC_S_DDR0_SCMO_HW_INFO_ADDR A:0x448010
y.create.l HWIO_BIMC_S_DDR0_SCMO_CONFIGURATION_INFO_0_ADDR A:0x448020
y.create.l HWIO_BIMC_S_DDR0_SCMO_CONFIGURATION_INFO_1_ADDR A:0x448030
y.create.l HWIO_BIMC_S_DDR0_SCMO_CONFIGURATION_INFO_2_ADDR A:0x448040
y.create.l HWIO_BIMC_S_DDR0_SCMO_CONFIGURATION_INFO_3_ADDR A:0x448050
y.create.l HWIO_BIMC_S_DDR0_SCMO_CONFIGURATION_INFO_4_ADDR A:0x448060
y.create.l HWIO_BIMC_S_DDR0_SCMO_CONFIGURATION_INFO_5_ADDR A:0x448070
y.create.l HWIO_BIMC_S_DDR0_SCMO_CONFIGURATION_INFO_6_ADDR A:0x448080
y.create.l HWIO_BIMC_S_DDR0_SCMO_INTERRUPT_STATUS_ADDR A:0x448100
y.create.l HWIO_BIMC_S_DDR0_SCMO_INTERRUPT_CLEAR_ADDR A:0x448108
y.create.l HWIO_BIMC_S_DDR0_SCMO_INTERRUPT_ENABLE_ADDR A:0x44810c
y.create.l HWIO_BIMC_S_DDR0_SCMO_ESYN_ADDR_ADDR A:0x448120
y.create.l HWIO_BIMC_S_DDR0_SCMO_ESYN_APACKET_0_ADDR A:0x448128
y.create.l HWIO_BIMC_S_DDR0_SCMO_ESYN_APACKET_1_ADDR A:0x44812c
y.create.l HWIO_BIMC_S_DDR0_SCMO_ESYN_APACKET_2_ADDR A:0x448130
y.create.l HWIO_BIMC_S_DDR0_SCMO_CLOCK_CTRL_ADDR A:0x448200
y.create.l HWIO_BIMC_S_DDR0_SCMO_SLV_INTERLEAVE_CFG_ADDR A:0x448400
y.create.l HWIO_BIMC_S_DDR0_SCMO_ADDR_BASE_CS0_ADDR A:0x448410
y.create.l HWIO_BIMC_S_DDR0_SCMO_ADDR_BASE_CS1_ADDR A:0x448414
y.create.l HWIO_BIMC_S_DDR0_SCMO_ADDR_MAP_CS0_ADDR A:0x448420
y.create.l HWIO_BIMC_S_DDR0_SCMO_ADDR_MAP_CS1_ADDR A:0x448424
y.create.l HWIO_BIMC_S_DDR0_SCMO_ADDR_MASK_CS0_ADDR A:0x448430
y.create.l HWIO_BIMC_S_DDR0_SCMO_ADDR_MASK_CS1_ADDR A:0x448434
y.create.l HWIO_BIMC_S_DDR0_SCMO_SLV_STATUS_ADDR A:0x448450
y.create.l HWIO_BIMC_S_DDR0_SCMO_GLOBAL_MON_CFG_ADDR A:0x448460
y.create.l HWIO_BIMC_S_DDR0_SCMO_CMD_BUF_CFG_ADDR A:0x448500
y.create.l HWIO_BIMC_S_DDR0_SCMO_CMD_BUF_STATUS_ADDR A:0x448520
y.create.l HWIO_BIMC_S_DDR0_SCMO_RCH_SELECT_ADDR A:0x448540
y.create.l HWIO_BIMC_S_DDR0_SCMO_RCH_BKPR_CFG_ADDR A:0x448544
y.create.l HWIO_BIMC_S_DDR0_SCMO_RCH_STATUS_ADDR A:0x448560
y.create.l HWIO_BIMC_S_DDR0_SCMO_WCH_BUF_CFG_ADDR A:0x448580
y.create.l HWIO_BIMC_S_DDR0_SCMO_WCH_STATUS_ADDR A:0x4485a0
y.create.l HWIO_BIMC_S_DDR0_SCMO_FLUSH_CFG_ADDR A:0x4485c0
y.create.l HWIO_BIMC_S_DDR0_SCMO_FLUSH_CMD_ADDR A:0x4485c4
y.create.l HWIO_BIMC_S_DDR0_SCMO_CMD_OPT_CFG0_ADDR A:0x448700
y.create.l HWIO_BIMC_S_DDR0_SCMO_CMD_OPT_CFG1_ADDR A:0x448704
y.create.l HWIO_BIMC_S_DDR0_SCMO_CMD_OPT_CFG2_ADDR A:0x448708
y.create.l HWIO_BIMC_S_DDR0_SCMO_CMD_OPT_CFG3_ADDR A:0x44870c
y.create.l HWIO_BIMC_S_DDR0_SCMO_CMD_OPT_CFG4_ADDR A:0x448710
y.create.l HWIO_BIMC_S_DDR0_SCMO_FSP_STATUS_ADDR A:0x448a40
y.create.l HWIO_BIMC_S_DDR0_XPU_SCR_ADDR A:0x44a000
y.create.l HWIO_BIMC_S_DDR0_XPU_SWDR_ADDR A:0x44a004
y.create.l HWIO_BIMC_S_DDR0_XPU_PRTN_RACR_SSHADOW_ADDR A:0x44a008
y.create.l HWIO_BIMC_S_DDR0_XPU_PRTN_WACR_SSHADOW_ADDR A:0x44a00c
y.create.l HWIO_BIMC_S_DDR0_XPU_PRTN_START_SSHADOW0_ADDR A:0x44a010
y.create.l HWIO_BIMC_S_DDR0_XPU_PRTN_END_SSHADOW0_ADDR A:0x44a018
y.create.l HWIO_BIMC_S_DDR0_XPU_SEAR0_ADDR A:0x44a040
y.create.l HWIO_BIMC_S_DDR0_XPU_SESR_ADDR A:0x44a048
y.create.l HWIO_BIMC_S_DDR0_XPU_SESRRESTORE_ADDR A:0x44a04c
y.create.l HWIO_BIMC_S_DDR0_XPU_SESYNR0_ADDR A:0x44a050
y.create.l HWIO_BIMC_S_DDR0_XPU_SESYNR1_ADDR A:0x44a054
y.create.l HWIO_BIMC_S_DDR0_XPU_SESYNR2_ADDR A:0x44a058
y.create.l HWIO_BIMC_S_DDR0_XPU_MCR_ADDR A:0x44a100
y.create.l HWIO_BIMC_S_DDR0_XPU_MEAR0_ADDR A:0x44a140
y.create.l HWIO_BIMC_S_DDR0_XPU_MESR_ADDR A:0x44a148
y.create.l HWIO_BIMC_S_DDR0_XPU_MESRRESTORE_ADDR A:0x44a14c
y.create.l HWIO_BIMC_S_DDR0_XPU_MESYNR0_ADDR A:0x44a150
y.create.l HWIO_BIMC_S_DDR0_XPU_MESYNR1_ADDR A:0x44a154
y.create.l HWIO_BIMC_S_DDR0_XPU_MESYNR2_ADDR A:0x44a158
y.create.l HWIO_BIMC_S_DDR0_XPU_CR_ADDR A:0x44a080
y.create.l HWIO_BIMC_S_DDR0_XPU_PRTN_RACR_SHADOW_ADDR A:0x44a088
y.create.l HWIO_BIMC_S_DDR0_XPU_PRTN_WACR_SHADOW_ADDR A:0x44a08c
y.create.l HWIO_BIMC_S_DDR0_XPU_PRTN_START_SHADOW0_ADDR A:0x44a090
y.create.l HWIO_BIMC_S_DDR0_XPU_PRTN_END_SHADOW0_ADDR A:0x44a098
y.create.l HWIO_BIMC_S_DDR0_XPU_RPU_ACR0_ADDR A:0x44a0a0
y.create.l HWIO_BIMC_S_DDR0_XPU_EAR0_ADDR A:0x44a0c0
y.create.l HWIO_BIMC_S_DDR0_XPU_ESR_ADDR A:0x44a0c8
y.create.l HWIO_BIMC_S_DDR0_XPU_ESRRESTORE_ADDR A:0x44a0cc
y.create.l HWIO_BIMC_S_DDR0_XPU_ESYNR0_ADDR A:0x44a0d0
y.create.l HWIO_BIMC_S_DDR0_XPU_ESYNR1_ADDR A:0x44a0d4
y.create.l HWIO_BIMC_S_DDR0_XPU_ESYNR2_ADDR A:0x44a0d8
y.create.l HWIO_BIMC_S_DDR0_XPU_UMR_RACR_ADDR A:0x44a0e0
y.create.l HWIO_BIMC_S_DDR0_XPU_UMR_WACR_ADDR A:0x44a0e4
y.create.l HWIO_BIMC_S_DDR0_XPU_UMR_CNTL_ADDR A:0x44a0f0
y.create.l HWIO_BIMC_S_DDR0_XPU_IDR0_ADDR A:0x44a074
y.create.l HWIO_BIMC_S_DDR0_XPU_IDR1_ADDR A:0x44a078
y.create.l HWIO_BIMC_S_DDR0_XPU_REV_ADDR A:0x44a07c
y.create.l HWIO_BIMC_S_DDR0_XPU_PRT0_RACR0_ADDR A:0x44a200
y.create.l HWIO_BIMC_S_DDR0_XPU_PRT1_RACR0_ADDR A:0x44a280
y.create.l HWIO_BIMC_S_DDR0_XPU_PRT2_RACR0_ADDR A:0x44a300
y.create.l HWIO_BIMC_S_DDR0_XPU_PRT3_RACR0_ADDR A:0x44a380
y.create.l HWIO_BIMC_S_DDR0_XPU_PRT4_RACR0_ADDR A:0x44a400
y.create.l HWIO_BIMC_S_DDR0_XPU_PRT5_RACR0_ADDR A:0x44a480
y.create.l HWIO_BIMC_S_DDR0_XPU_PRT6_RACR0_ADDR A:0x44a500
y.create.l HWIO_BIMC_S_DDR0_XPU_PRT7_RACR0_ADDR A:0x44a580
y.create.l HWIO_BIMC_S_DDR0_XPU_PRT8_RACR0_ADDR A:0x44a600
y.create.l HWIO_BIMC_S_DDR0_XPU_PRT9_RACR0_ADDR A:0x44a680
y.create.l HWIO_BIMC_S_DDR0_XPU_PRT0_WACR0_ADDR A:0x44a220
y.create.l HWIO_BIMC_S_DDR0_XPU_PRT1_WACR0_ADDR A:0x44a2a0
y.create.l HWIO_BIMC_S_DDR0_XPU_PRT2_WACR0_ADDR A:0x44a320
y.create.l HWIO_BIMC_S_DDR0_XPU_PRT3_WACR0_ADDR A:0x44a3a0
y.create.l HWIO_BIMC_S_DDR0_XPU_PRT4_WACR0_ADDR A:0x44a420
y.create.l HWIO_BIMC_S_DDR0_XPU_PRT5_WACR0_ADDR A:0x44a4a0
y.create.l HWIO_BIMC_S_DDR0_XPU_PRT6_WACR0_ADDR A:0x44a520
y.create.l HWIO_BIMC_S_DDR0_XPU_PRT7_WACR0_ADDR A:0x44a5a0
y.create.l HWIO_BIMC_S_DDR0_XPU_PRT8_WACR0_ADDR A:0x44a620
y.create.l HWIO_BIMC_S_DDR0_XPU_PRT9_WACR0_ADDR A:0x44a6a0
y.create.l HWIO_BIMC_S_DDR0_XPU_PRT0_START0_ADDR A:0x44a240
y.create.l HWIO_BIMC_S_DDR0_XPU_PRT1_START0_ADDR A:0x44a2c0
y.create.l HWIO_BIMC_S_DDR0_XPU_PRT2_START0_ADDR A:0x44a340
y.create.l HWIO_BIMC_S_DDR0_XPU_PRT3_START0_ADDR A:0x44a3c0
y.create.l HWIO_BIMC_S_DDR0_XPU_PRT4_START0_ADDR A:0x44a440
y.create.l HWIO_BIMC_S_DDR0_XPU_PRT5_START0_ADDR A:0x44a4c0
y.create.l HWIO_BIMC_S_DDR0_XPU_PRT6_START0_ADDR A:0x44a540
y.create.l HWIO_BIMC_S_DDR0_XPU_PRT7_START0_ADDR A:0x44a5c0
y.create.l HWIO_BIMC_S_DDR0_XPU_PRT8_START0_ADDR A:0x44a640
y.create.l HWIO_BIMC_S_DDR0_XPU_PRT9_START0_ADDR A:0x44a6c0
y.create.l HWIO_BIMC_S_DDR0_XPU_PRT0_END0_ADDR A:0x44a248
y.create.l HWIO_BIMC_S_DDR0_XPU_PRT1_END0_ADDR A:0x44a2c8
y.create.l HWIO_BIMC_S_DDR0_XPU_PRT2_END0_ADDR A:0x44a348
y.create.l HWIO_BIMC_S_DDR0_XPU_PRT3_END0_ADDR A:0x44a3c8
y.create.l HWIO_BIMC_S_DDR0_XPU_PRT4_END0_ADDR A:0x44a448
y.create.l HWIO_BIMC_S_DDR0_XPU_PRT5_END0_ADDR A:0x44a4c8
y.create.l HWIO_BIMC_S_DDR0_XPU_PRT6_END0_ADDR A:0x44a548
y.create.l HWIO_BIMC_S_DDR0_XPU_PRT7_END0_ADDR A:0x44a5c8
y.create.l HWIO_BIMC_S_DDR0_XPU_PRT8_END0_ADDR A:0x44a648
y.create.l HWIO_BIMC_S_DDR0_XPU_PRT9_END0_ADDR A:0x44a6c8
y.create.l HWIO_BIMC_S_DDR0_XPU_PRT0_SCR_ADDR A:0x44a250
y.create.l HWIO_BIMC_S_DDR0_XPU_PRT1_SCR_ADDR A:0x44a2d0
y.create.l HWIO_BIMC_S_DDR0_XPU_PRT2_SCR_ADDR A:0x44a350
y.create.l HWIO_BIMC_S_DDR0_XPU_PRT3_SCR_ADDR A:0x44a3d0
y.create.l HWIO_BIMC_S_DDR0_XPU_PRT4_SCR_ADDR A:0x44a450
y.create.l HWIO_BIMC_S_DDR0_XPU_PRT5_SCR_ADDR A:0x44a4d0
y.create.l HWIO_BIMC_S_DDR0_XPU_PRT6_SCR_ADDR A:0x44a550
y.create.l HWIO_BIMC_S_DDR0_XPU_PRT7_SCR_ADDR A:0x44a5d0
y.create.l HWIO_BIMC_S_DDR0_XPU_PRT8_SCR_ADDR A:0x44a650
y.create.l HWIO_BIMC_S_DDR0_XPU_PRT9_SCR_ADDR A:0x44a6d0
y.create.l HWIO_BIMC_S_DDR0_XPU_PRT0_MCR_ADDR A:0x44a254
y.create.l HWIO_BIMC_S_DDR0_XPU_PRT1_MCR_ADDR A:0x44a2d4
y.create.l HWIO_BIMC_S_DDR0_XPU_PRT2_MCR_ADDR A:0x44a354
y.create.l HWIO_BIMC_S_DDR0_XPU_PRT3_MCR_ADDR A:0x44a3d4
y.create.l HWIO_BIMC_S_DDR0_XPU_PRT4_MCR_ADDR A:0x44a454
y.create.l HWIO_BIMC_S_DDR0_XPU_PRT5_MCR_ADDR A:0x44a4d4
y.create.l HWIO_BIMC_S_DDR0_XPU_PRT6_MCR_ADDR A:0x44a554
y.create.l HWIO_BIMC_S_DDR0_XPU_PRT7_MCR_ADDR A:0x44a5d4
y.create.l HWIO_BIMC_S_DDR0_XPU_PRT8_MCR_ADDR A:0x44a654
y.create.l HWIO_BIMC_S_DDR0_XPU_PRT9_MCR_ADDR A:0x44a6d4
y.create.l HWIO_BIMC_S_DDR0_XPU_PRT0_CNTL0_ADDR A:0x44a258
y.create.l HWIO_BIMC_S_DDR0_XPU_PRT1_CNTL0_ADDR A:0x44a2d8
y.create.l HWIO_BIMC_S_DDR0_XPU_PRT2_CNTL0_ADDR A:0x44a358
y.create.l HWIO_BIMC_S_DDR0_XPU_PRT3_CNTL0_ADDR A:0x44a3d8
y.create.l HWIO_BIMC_S_DDR0_XPU_PRT4_CNTL0_ADDR A:0x44a458
y.create.l HWIO_BIMC_S_DDR0_XPU_PRT5_CNTL0_ADDR A:0x44a4d8
y.create.l HWIO_BIMC_S_DDR0_XPU_PRT6_CNTL0_ADDR A:0x44a558
y.create.l HWIO_BIMC_S_DDR0_XPU_PRT7_CNTL0_ADDR A:0x44a5d8
y.create.l HWIO_BIMC_S_DDR0_XPU_PRT8_CNTL0_ADDR A:0x44a658
y.create.l HWIO_BIMC_S_DDR0_XPU_PRT9_CNTL0_ADDR A:0x44a6d8
y.create.l HWIO_BIMC_S_DDR0_XPU_PRT0_CNTL1_ADDR A:0x44a25c
y.create.l HWIO_BIMC_S_DDR0_XPU_PRT1_CNTL1_ADDR A:0x44a2dc
y.create.l HWIO_BIMC_S_DDR0_XPU_PRT2_CNTL1_ADDR A:0x44a35c
y.create.l HWIO_BIMC_S_DDR0_XPU_PRT3_CNTL1_ADDR A:0x44a3dc
y.create.l HWIO_BIMC_S_DDR0_XPU_PRT4_CNTL1_ADDR A:0x44a45c
y.create.l HWIO_BIMC_S_DDR0_XPU_PRT5_CNTL1_ADDR A:0x44a4dc
y.create.l HWIO_BIMC_S_DDR0_XPU_PRT6_CNTL1_ADDR A:0x44a55c
y.create.l HWIO_BIMC_S_DDR0_XPU_PRT7_CNTL1_ADDR A:0x44a5dc
y.create.l HWIO_BIMC_S_DDR0_XPU_PRT8_CNTL1_ADDR A:0x44a65c
y.create.l HWIO_BIMC_S_DDR0_XPU_PRT9_CNTL1_ADDR A:0x44a6dc
y.create.l HWIO_BIMC_S_DDR0_XPU_AMT_RACR_ADDR A:0x44a0e8
y.create.l HWIO_BIMC_S_DDR0_XPU_AMT_WACR_ADDR A:0x44a0ec
y.create.l HWIO_BIMC_S_DDR0_XPU_AMTR0_ADDR A:0x44ae80
y.create.l HWIO_BIMC_S_DDR0_XPU_AMTR1_ADDR A:0x44ae84
y.create.l HWIO_BIMC_S_DDR0_XPU_AMTR2_ADDR A:0x44ae88
y.create.l HWIO_BIMC_S_DDR0_XPU_AMTR3_ADDR A:0x44ae8c
y.create.l HWIO_BIMC_S_DDR0_XPU_AMTR4_ADDR A:0x44ae90
y.create.l HWIO_BIMC_S_DDR0_XPU_AMTR5_ADDR A:0x44ae94
y.create.l HWIO_BIMC_S_DDR0_XPU_AMTR6_ADDR A:0x44ae98
y.create.l HWIO_BIMC_S_DDR0_XPU_AMTR7_ADDR A:0x44ae9c
y.create.l HWIO_BIMC_S_DDR0_XPU_AMTR8_ADDR A:0x44aea0
y.create.l HWIO_BIMC_S_DDR0_XPU_AMTR9_ADDR A:0x44aea4
y.create.l HWIO_BIMC_S_DDR0_DPE_HW_INFO_ADDR A:0x44c000
y.create.l HWIO_BIMC_S_DDR0_DPE_CONFIG_0_ADDR A:0x44c010
y.create.l HWIO_BIMC_S_DDR0_DPE_CONFIG_1_ADDR A:0x44c014
y.create.l HWIO_BIMC_S_DDR0_DPE_CONFIG_2_ADDR A:0x44c018
y.create.l HWIO_BIMC_S_DDR0_DPE_CONFIG_3_ADDR A:0x44c01c
y.create.l HWIO_BIMC_S_DDR0_DPE_CONFIG_4_ADDR A:0x44c020
y.create.l HWIO_BIMC_S_DDR0_DPE_CONFIG_5_ADDR A:0x44c024
y.create.l HWIO_BIMC_S_DDR0_DPE_CONFIG_6_ADDR A:0x44c028
y.create.l HWIO_BIMC_S_DDR0_DPE_CONFIG_7_ADDR A:0x44c02c
y.create.l HWIO_BIMC_S_DDR0_DPE_CONFIG_DQ_MAP_ADDR A:0x44c038
y.create.l HWIO_BIMC_S_DDR0_DPE_ODT_CONFIG_0_ADDR A:0x44c040
y.create.l HWIO_BIMC_S_DDR0_DPE_ODT_CONFIG_1_ADDR A:0x44c044
y.create.l HWIO_BIMC_S_DDR0_DPE_CA_TRAIN_PRE_CS_ADDR A:0x44c050
y.create.l HWIO_BIMC_S_DDR0_DPE_CA_TRAIN_CS_ADDR A:0x44c054
y.create.l HWIO_BIMC_S_DDR0_DPE_CA_TRAIN_POST_CS_ADDR A:0x44c058
y.create.l HWIO_BIMC_S_DDR0_DPE_RCW_CTRL_ADDR A:0x44c060
y.create.l HWIO_BIMC_S_DDR0_DPE_PWR_CTRL_0_ADDR A:0x44c068
y.create.l HWIO_BIMC_S_DDR0_DPE_OPT_CTRL_0_ADDR A:0x44c078
y.create.l HWIO_BIMC_S_DDR0_DPE_OPT_CTRL_1_ADDR A:0x44c07c
y.create.l HWIO_BIMC_S_DDR0_DPE_DRAM_STATUS_0_ADDR A:0x44c08c
y.create.l HWIO_BIMC_S_DDR0_DPE_MEMC_STATUS_0_ADDR A:0x44c09c
y.create.l HWIO_BIMC_S_DDR0_DPE_MEMC_STATUS_1_ADDR A:0x44c0a0
y.create.l HWIO_BIMC_S_DDR0_DPE_MEMC_STATUS_2_ADDR A:0x44c0a4
y.create.l HWIO_BIMC_S_DDR0_DPE_INTERRUPT_ENABLE_ADDR A:0x44c0b4
y.create.l HWIO_BIMC_S_DDR0_DPE_INTERRUPT_STATUS_ADDR A:0x44c0b8
y.create.l HWIO_BIMC_S_DDR0_DPE_INTERRUPT_CLR_ADDR A:0x44c0bc
y.create.l HWIO_BIMC_S_DDR0_DPE_INTERRUPT_SET_ADDR A:0x44c0c0
y.create.l HWIO_BIMC_S_DDR0_DPE_ELEVATE_PRI_RD_ADDR A:0x44c0d0
y.create.l HWIO_BIMC_S_DDR0_DPE_ELEVATE_PRI_WR_ADDR A:0x44c0d4
y.create.l HWIO_BIMC_S_DDR0_DPE_TIMER_0_ADDR A:0x44c0e4
y.create.l HWIO_BIMC_S_DDR0_DPE_TIMER_1_ADDR A:0x44c0e8
y.create.l HWIO_BIMC_S_DDR0_DPE_TIMER_2_ADDR A:0x44c0ec
y.create.l HWIO_BIMC_S_DDR0_DPE_TIMER_3_ADDR A:0x44c0f0
y.create.l HWIO_BIMC_S_DDR0_DPE_MRW_BEFORE_FREQ_SWITCH_0_ADDR A:0x44c114
y.create.l HWIO_BIMC_S_DDR0_DPE_MRW_BEFORE_FREQ_SWITCH_1_ADDR A:0x44c118
y.create.l HWIO_BIMC_S_DDR0_DPE_MRW_BEFORE_FREQ_SWITCH_2_ADDR A:0x44c11c
y.create.l HWIO_BIMC_S_DDR0_DPE_MRW_BEFORE_FREQ_SWITCH_3_ADDR A:0x44c120
y.create.l HWIO_BIMC_S_DDR0_DPE_MRW_AFTER_FREQ_SWITCH_0_ADDR A:0x44c124
y.create.l HWIO_BIMC_S_DDR0_DPE_MRW_AFTER_FREQ_SWITCH_1_ADDR A:0x44c128
y.create.l HWIO_BIMC_S_DDR0_DPE_MRW_AFTER_FREQ_SWITCH_2_ADDR A:0x44c12c
y.create.l HWIO_BIMC_S_DDR0_DPE_MRW_AFTER_FREQ_SWITCH_3_ADDR A:0x44c130
y.create.l HWIO_BIMC_S_DDR0_DPE_MRW_FREQ_SWITCH_ADDR A:0x44c134
y.create.l HWIO_BIMC_S_DDR0_DPE_DRAM_TIMING_0_ADDR A:0x44c144
y.create.l HWIO_BIMC_S_DDR0_DPE_DRAM_TIMING_1_ADDR A:0x44c148
y.create.l HWIO_BIMC_S_DDR0_DPE_DRAM_TIMING_2_ADDR A:0x44c14c
y.create.l HWIO_BIMC_S_DDR0_DPE_DRAM_TIMING_3_ADDR A:0x44c150
y.create.l HWIO_BIMC_S_DDR0_DPE_DRAM_TIMING_4_ADDR A:0x44c154
y.create.l HWIO_BIMC_S_DDR0_DPE_DRAM_TIMING_5_ADDR A:0x44c158
y.create.l HWIO_BIMC_S_DDR0_DPE_DRAM_TIMING_6_ADDR A:0x44c15c
y.create.l HWIO_BIMC_S_DDR0_DPE_DRAM_TIMING_7_ADDR A:0x44c160
y.create.l HWIO_BIMC_S_DDR0_DPE_DRAM_TIMING_8_ADDR A:0x44c164
y.create.l HWIO_BIMC_S_DDR0_DPE_DRAM_TIMING_9_ADDR A:0x44c168
y.create.l HWIO_BIMC_S_DDR0_DPE_DRAM_TIMING_10_ADDR A:0x44c16c
y.create.l HWIO_BIMC_S_DDR0_DPE_DRAM_TIMING_11_ADDR A:0x44c170
y.create.l HWIO_BIMC_S_DDR0_DPE_DRAM_TIMING_12_ADDR A:0x44c174
y.create.l HWIO_BIMC_S_DDR0_DPE_DRAM_TIMING_13_ADDR A:0x44c178
y.create.l HWIO_BIMC_S_DDR0_DPE_DRAM_TIMING_14_ADDR A:0x44c17c
y.create.l HWIO_BIMC_S_DDR0_DPE_DRAM_TIMING_15_ADDR A:0x44c180
y.create.l HWIO_BIMC_S_DDR0_DPE_DRAM_TIMING_16_ADDR A:0x44c184
y.create.l HWIO_BIMC_S_DDR0_DPE_DRAM_TIMING_17_ADDR A:0x44c188
y.create.l HWIO_BIMC_S_DDR0_DPE_DRAM_TIMING_18_ADDR A:0x44c18c
y.create.l HWIO_BIMC_S_DDR0_DPE_DRAM_TIMING_19_ADDR A:0x44c190
y.create.l HWIO_BIMC_S_DDR0_DPE_DRAM_TIMING_20_ADDR A:0x44c194
y.create.l HWIO_BIMC_S_DDR0_DPE_DRAM_TIMING_21_ADDR A:0x44c198
y.create.l HWIO_BIMC_S_DDR0_DPE_DRAM_TIMING_22_ADDR A:0x44c19c
y.create.l HWIO_BIMC_S_DDR0_DPE_DRAM_TIMING_23_ADDR A:0x44c1a0
y.create.l HWIO_BIMC_S_DDR0_DPE_DRAM_TIMING_0_ACT_ADDR A:0x44c1a4
y.create.l HWIO_BIMC_S_DDR0_DPE_DRAM_TIMING_1_ACT_ADDR A:0x44c1a8
y.create.l HWIO_BIMC_S_DDR0_DPE_DRAM_TIMING_2_ACT_ADDR A:0x44c1ac
y.create.l HWIO_BIMC_S_DDR0_DPE_DRAM_TIMING_3_ACT_ADDR A:0x44c1b0
y.create.l HWIO_BIMC_S_DDR0_DPE_DRAM_TIMING_4_ACT_ADDR A:0x44c1b4
y.create.l HWIO_BIMC_S_DDR0_DPE_DRAM_TIMING_5_ACT_ADDR A:0x44c1b8
y.create.l HWIO_BIMC_S_DDR0_DPE_DRAM_TIMING_6_ACT_ADDR A:0x44c1bc
y.create.l HWIO_BIMC_S_DDR0_DPE_DRAM_TIMING_7_ACT_ADDR A:0x44c1c0
y.create.l HWIO_BIMC_S_DDR0_DPE_DRAM_TIMING_8_ACT_ADDR A:0x44c1c4
y.create.l HWIO_BIMC_S_DDR0_DPE_DRAM_TIMING_9_ACT_ADDR A:0x44c1c8
y.create.l HWIO_BIMC_S_DDR0_DPE_DRAM_TIMING_10_ACT_ADDR A:0x44c1cc
y.create.l HWIO_BIMC_S_DDR0_DPE_DRAM_TIMING_11_ACT_ADDR A:0x44c1d0
y.create.l HWIO_BIMC_S_DDR0_DPE_DRAM_TIMING_12_ACT_ADDR A:0x44c1d4
y.create.l HWIO_BIMC_S_DDR0_DPE_DRAM_TIMING_13_ACT_ADDR A:0x44c1d8
y.create.l HWIO_BIMC_S_DDR0_DPE_DRAM_TIMING_14_ACT_ADDR A:0x44c1dc
y.create.l HWIO_BIMC_S_DDR0_DPE_DRAM_TIMING_15_ACT_ADDR A:0x44c1e0
y.create.l HWIO_BIMC_S_DDR0_DPE_DRAM_TIMING_16_ACT_ADDR A:0x44c1e4
y.create.l HWIO_BIMC_S_DDR0_DPE_DRAM_TIMING_17_ACT_ADDR A:0x44c1e8
y.create.l HWIO_BIMC_S_DDR0_DPE_DRAM_TIMING_18_ACT_ADDR A:0x44c1ec
y.create.l HWIO_BIMC_S_DDR0_DPE_DRAM_TIMING_19_ACT_ADDR A:0x44c1f0
y.create.l HWIO_BIMC_S_DDR0_DPE_DRAM_TIMING_20_ACT_ADDR A:0x44c1f4
y.create.l HWIO_BIMC_S_DDR0_DPE_DRAM_TIMING_21_ACT_ADDR A:0x44c1f8
y.create.l HWIO_BIMC_S_DDR0_DPE_DRAM_TIMING_22_ACT_ADDR A:0x44c1fc
y.create.l HWIO_BIMC_S_DDR0_DPE_DRAM_TIMING_23_ACT_ADDR A:0x44c200
y.create.l HWIO_BIMC_S_DDR0_DPE_TESTBUS_CTRL_ADDR A:0x44c204
y.create.l HWIO_BIMC_S_DDR0_DPE_SPARE_REG_ADDR A:0x44c214
y.create.l HWIO_BIMC_S_DDR0_DPE_SPARE_REG_ACT_ADDR A:0x44c224
y.create.l HWIO_BIMC_S_DDR0_DPE_DQCAL_RDATA_RANK1_U_ADDR A:0x44c240
y.create.l HWIO_BIMC_S_DDR0_DPE_DQCAL_RDATA_RANK1_L_ADDR A:0x44c244
y.create.l HWIO_BIMC_S_DDR0_DPE_DQCAL_RDATA_RANK0_U_ADDR A:0x44c248
y.create.l HWIO_BIMC_S_DDR0_DPE_DQCAL_RDATA_RANK0_L_ADDR A:0x44c24c
y.create.l HWIO_BIMC_S_DDR0_DPE_DQCAL_STATUS0_RANK1_ADDR A:0x44c260
y.create.l HWIO_BIMC_S_DDR0_DPE_DQCAL_STATUS1_RANK1_ADDR A:0x44c264
y.create.l HWIO_BIMC_S_DDR0_DPE_DQCAL_STATUS2_RANK1_ADDR A:0x44c268
y.create.l HWIO_BIMC_S_DDR0_DPE_DQCAL_STATUS0_RANK0_ADDR A:0x44c280
y.create.l HWIO_BIMC_S_DDR0_DPE_DQCAL_STATUS1_RANK0_ADDR A:0x44c284
y.create.l HWIO_BIMC_S_DDR0_DPE_DQCAL_STATUS2_RANK0_ADDR A:0x44c288
y.create.l HWIO_BIMC_S_DDR0_DPE_CGC_CTRL_ADDR A:0x44c2fc
y.create.l HWIO_BIMC_S_DDR0_DPE_PMON_EN_ADDR A:0x44c300
y.create.l HWIO_BIMC_S_DDR0_DPE_PMON_CFG_ADDR A:0x44c304
y.create.l HWIO_BIMC_S_DDR0_DPE_PMON_CMD_QUEUED_0_ADDR A:0x44c310
y.create.l HWIO_BIMC_S_DDR0_DPE_PMON_CMD_QUEUED_1_ADDR A:0x44c314
y.create.l HWIO_BIMC_S_DDR0_DPE_PMON_CMD_QUEUED_2_ADDR A:0x44c318
y.create.l HWIO_BIMC_S_DDR0_DPE_PMON_CMD_QUEUED_3_ADDR A:0x44c31c
y.create.l HWIO_BIMC_S_DDR0_DPE_PMON_CMD_EXEC_0_ADDR A:0x44c320
y.create.l HWIO_BIMC_S_DDR0_DPE_PMON_CMD_EXEC_1_ADDR A:0x44c324
y.create.l HWIO_BIMC_S_DDR0_DPE_PMON_CMD_EXEC_2_ADDR A:0x44c328
y.create.l HWIO_BIMC_S_DDR0_DPE_PMON_CMD_EXEC_3_ADDR A:0x44c32c
y.create.l HWIO_BIMC_S_DDR0_DPE_PMON_CMD_FLTR_0_ADDR A:0x44c330
y.create.l HWIO_BIMC_S_DDR0_DPE_PMON_CMD_FLTR_1_ADDR A:0x44c334
y.create.l HWIO_BIMC_S_DDR0_DPE_PMON_CMD_FLTR_2_ADDR A:0x44c338
y.create.l HWIO_BIMC_S_DDR0_DPE_PMON_CMD_FLTR_3_ADDR A:0x44c33c
y.create.l HWIO_BIMC_S_DDR0_DPE_PMON_ADDR_FLTR_0_ADDR A:0x44c340
y.create.l HWIO_BIMC_S_DDR0_DPE_PMON_ADDR_FLTR_1_ADDR A:0x44c344
y.create.l HWIO_BIMC_S_DDR0_DPE_PMON_ADDR_FLTR_2_ADDR A:0x44c348
y.create.l HWIO_BIMC_S_DDR0_DPE_PMON_ADDR_FLTR_3_ADDR A:0x44c34c
y.create.l HWIO_BIMC_S_DDR0_DPE_PMON_MID_FLTR_0_ADDR A:0x44c350
y.create.l HWIO_BIMC_S_DDR0_DPE_PMON_MID_FLTR_1_ADDR A:0x44c354
y.create.l HWIO_BIMC_S_DDR0_DPE_PMON_LAT_LIM_0_ADDR A:0x44c360
y.create.l HWIO_BIMC_S_DDR0_DPE_PMON_LAT_LIM_1_ADDR A:0x44c364
y.create.l HWIO_BIMC_S_DDR0_DPE_PMON_LAT_LIM_2_ADDR A:0x44c368
y.create.l HWIO_BIMC_S_DDR0_DPE_PMON_LAT_LIM_3_ADDR A:0x44c36c
y.create.l HWIO_BIMC_S_DDR0_DPE_PMON_PRI_FLTR_0_ADDR A:0x44c370
y.create.l HWIO_BIMC_S_DDR0_DPE_PMON_PRI_FLTR_1_ADDR A:0x44c374
y.create.l HWIO_BIMC_S_DDR0_DPE_PMON_PRI_FLTR_2_ADDR A:0x44c378
y.create.l HWIO_BIMC_S_DDR0_DPE_PMON_PRI_FLTR_3_ADDR A:0x44c37c
y.create.l HWIO_BIMC_S_DDR0_DPE_PMON_CMDQ_0_ADDR A:0x44c380
y.create.l HWIO_BIMC_S_DDR0_DPE_PMON_CMDQ_1_ADDR A:0x44c384
y.create.l HWIO_BIMC_S_DDR0_DPE_PMON_WRBUF_0_ADDR A:0x44c388
y.create.l HWIO_BIMC_S_DDR0_DPE_PMON_WRBUF_1_ADDR A:0x44c38c
y.create.l HWIO_BIMC_S_DDR0_DPE_PMON_DDR_CMD_0_ADDR A:0x44c390
y.create.l HWIO_BIMC_S_DDR0_DPE_PMON_DDR_CMD_1_ADDR A:0x44c394
y.create.l HWIO_BIMC_S_DDR0_DPE_PMON_DDR_CMD_2_ADDR A:0x44c398
y.create.l HWIO_BIMC_S_DDR0_DPE_PMON_DDR_CMD_3_ADDR A:0x44c39c
y.create.l HWIO_BIMC_S_DDR0_DPE_PMON_DDR_DATA_0_ADDR A:0x44c3a0
y.create.l HWIO_BIMC_S_DDR0_DPE_PMON_DDR_DATA_1_ADDR A:0x44c3a4
y.create.l HWIO_BIMC_S_DDR0_DPE_PMON_RANK_STATE_0_ADDR A:0x44c3b0
y.create.l HWIO_BIMC_S_DDR0_DPE_PMON_RANK_STATE_1_ADDR A:0x44c3b4
y.create.l HWIO_BIMC_S_DDR0_DPE_PMON_RANK_STATE_2_ADDR A:0x44c3b8
y.create.l HWIO_BIMC_S_DDR0_DPE_PMON_RANK_STATE_3_ADDR A:0x44c3bc
y.create.l HWIO_BIMC_S_DDR0_DPE_PMON_SHKE_0_ADDR A:0x44c3c0
y.create.l HWIO_BIMC_S_DDR0_DPE_PMON_SHKE_1_ADDR A:0x44c3c4
y.create.l HWIO_BIMC_S_DDR0_DPE_PMON_SHKE_2_ADDR A:0x44c3c8
y.create.l HWIO_BIMC_S_DDR0_DPE_PMON_SHKE_3_ADDR A:0x44c3cc
y.create.l HWIO_BIMC_S_DDR0_DPE_PMON_SHKE_4_ADDR A:0x44c3d0
y.create.l HWIO_BIMC_S_DDR0_DPE_PMON_SHKE_5_ADDR A:0x44c3d4
y.create.l HWIO_BIMC_S_DDR0_DPE_PMON_SHKE_6_ADDR A:0x44c3d8
y.create.l HWIO_BIMC_S_DDR0_DPE_PMON_SHKE_7_ADDR A:0x44c3dc
y.create.l HWIO_BIMC_S_DDR0_DPE_DERATE_TEMP_CTRL_ADDR A:0x44c6e0
y.create.l HWIO_BIMC_S_DDR0_DPE_WR_DATA_CTRL_ADDR A:0x44c6e4
y.create.l HWIO_BIMC_S_DDR0_SHKE_HW_INFO_ADDR A:0x44d000
y.create.l HWIO_BIMC_S_DDR0_SHKE_CONFIG_ADDR A:0x44d004
y.create.l HWIO_BIMC_S_DDR0_SHKE_CGC_CNTL_ADDR A:0x44d010
y.create.l HWIO_BIMC_S_DDR0_SHKE_DRAM_MANUAL_0_ADDR A:0x44d020
y.create.l HWIO_BIMC_S_DDR0_SHKE_DRAM_MANUAL_1_ADDR A:0x44d024
y.create.l HWIO_BIMC_S_DDR0_SHKE_MREG_ADDR_WDATA_CNTL_ADDR A:0x44d030
y.create.l HWIO_BIMC_S_DDR0_SHKE_MREG_RDATA_RANK1_U_ADDR A:0x44d050
y.create.l HWIO_BIMC_S_DDR0_SHKE_MREG_RDATA_RANK1_L_ADDR A:0x44d054
y.create.l HWIO_BIMC_S_DDR0_SHKE_MREG_RDATA_RANK0_U_ADDR A:0x44d060
y.create.l HWIO_BIMC_S_DDR0_SHKE_MREG_RDATA_RANK0_L_ADDR A:0x44d064
y.create.l HWIO_BIMC_S_DDR0_SHKE_MREG_RDATA_STATUS_ADDR A:0x44d070
y.create.l HWIO_BIMC_S_DDR0_SHKE_DRAM_STATUS_ADDR A:0x44d074
y.create.l HWIO_BIMC_S_DDR0_SHKE_DRAM_DEBUG_CMD_0_ADDR A:0x44d080
y.create.l HWIO_BIMC_S_DDR0_SHKE_DRAM_DEBUG_CMD_1_ADDR A:0x44d084
y.create.l HWIO_BIMC_S_DDR0_SHKE_DRAM_DEBUG_CMD_2_ADDR A:0x44d088
y.create.l HWIO_BIMC_S_DDR0_SHKE_PERIODIC_MRR_ADDR A:0x44d0a0
y.create.l HWIO_BIMC_S_DDR0_SHKE_PERIODIC_MRR_RDATA_RANK1_U_ADDR A:0x44d0b0
y.create.l HWIO_BIMC_S_DDR0_SHKE_PERIODIC_MRR_RDATA_RANK1_L_ADDR A:0x44d0b4
y.create.l HWIO_BIMC_S_DDR0_SHKE_PERIODIC_MRR_RDATA_RANK0_U_ADDR A:0x44d0b8
y.create.l HWIO_BIMC_S_DDR0_SHKE_PERIODIC_MRR_RDATA_RANK0_L_ADDR A:0x44d0bc
y.create.l HWIO_BIMC_S_DDR0_SHKE_PERIODIC_ZQCAL_ADDR A:0x44d0d0
y.create.l HWIO_BIMC_S_DDR0_SHKE_AUTO_REFRESH_CNTL_ADDR A:0x44d0f0
y.create.l HWIO_BIMC_S_DDR0_SHKE_SELF_REFRESH_CNTL_ADDR A:0x44d0f4
y.create.l HWIO_BIMC_S_DDR0_SHKE_AUTO_REFRESH_CNTL_1_ADDR A:0x44d100
y.create.l HWIO_BIMC_S_DDR0_SHKE_AUTO_REFRESH_CNTL_2_ADDR A:0x44d104
y.create.l HWIO_BIMC_S_DDR0_SHKE_TESTBUS_CNTL_ADDR A:0x44d114
y.create.l HWIO_BIMC_S_DDR0_SHKE_SPARE_REG_ADDR A:0x44d130
y.create.l HWIO_BIMC_S_DDR0_SHKE_DERATE_REF_RANK0_ADDR A:0x44d0c0
y.create.l HWIO_BIMC_S_DDR0_SHKE_DERATE_REF_RANK1_ADDR A:0x44d0c4
y.create.l HWIO_BIMC_MPU_XPU_SCR_ADDR A:0x32000
y.create.l HWIO_BIMC_MPU_XPU_SWDR_ADDR A:0x32004
y.create.l HWIO_BIMC_MPU_XPU_PRTN_RACR_SSHADOW_ADDR A:0x32008
y.create.l HWIO_BIMC_MPU_XPU_PRTN_START_SSHADOW0_ADDR A:0x32010
y.create.l HWIO_BIMC_MPU_XPU_PRTN_END_SSHADOW0_ADDR A:0x32018
y.create.l HWIO_BIMC_MPU_XPU_SEAR0_ADDR A:0x32040
y.create.l HWIO_BIMC_MPU_XPU_SESR_ADDR A:0x32048
y.create.l HWIO_BIMC_MPU_XPU_SESRRESTORE_ADDR A:0x3204c
y.create.l HWIO_BIMC_MPU_XPU_SESYNR0_ADDR A:0x32050
y.create.l HWIO_BIMC_MPU_XPU_SESYNR1_ADDR A:0x32054
y.create.l HWIO_BIMC_MPU_XPU_SESYNR2_ADDR A:0x32058
y.create.l HWIO_BIMC_MPU_XPU_MCR_ADDR A:0x32100
y.create.l HWIO_BIMC_MPU_XPU_MEAR0_ADDR A:0x32140
y.create.l HWIO_BIMC_MPU_XPU_MESR_ADDR A:0x32148
y.create.l HWIO_BIMC_MPU_XPU_MESRRESTORE_ADDR A:0x3214c
y.create.l HWIO_BIMC_MPU_XPU_MESYNR0_ADDR A:0x32150
y.create.l HWIO_BIMC_MPU_XPU_MESYNR1_ADDR A:0x32154
y.create.l HWIO_BIMC_MPU_XPU_MESYNR2_ADDR A:0x32158
y.create.l HWIO_BIMC_MPU_XPU_CR_ADDR A:0x32080
y.create.l HWIO_BIMC_MPU_XPU_PRTN_RACR_SHADOW_ADDR A:0x32088
y.create.l HWIO_BIMC_MPU_XPU_PRTN_START_SHADOW0_ADDR A:0x32090
y.create.l HWIO_BIMC_MPU_XPU_PRTN_END_SHADOW0_ADDR A:0x32098
y.create.l HWIO_BIMC_MPU_XPU_RPU_ACR0_ADDR A:0x320a0
y.create.l HWIO_BIMC_MPU_XPU_EAR0_ADDR A:0x320c0
y.create.l HWIO_BIMC_MPU_XPU_ESR_ADDR A:0x320c8
y.create.l HWIO_BIMC_MPU_XPU_ESRRESTORE_ADDR A:0x320cc
y.create.l HWIO_BIMC_MPU_XPU_ESYNR0_ADDR A:0x320d0
y.create.l HWIO_BIMC_MPU_XPU_ESYNR1_ADDR A:0x320d4
y.create.l HWIO_BIMC_MPU_XPU_ESYNR2_ADDR A:0x320d8
y.create.l HWIO_BIMC_MPU_XPU_UMR_RACR_ADDR A:0x320e0
y.create.l HWIO_BIMC_MPU_XPU_UMR_WACR_ADDR A:0x320e4
y.create.l HWIO_BIMC_MPU_XPU_UMR_CNTL_ADDR A:0x320f0
y.create.l HWIO_BIMC_MPU_XPU_IDR0_ADDR A:0x32074
y.create.l HWIO_BIMC_MPU_XPU_IDR1_ADDR A:0x32078
y.create.l HWIO_BIMC_MPU_XPU_REV_ADDR A:0x3207c
y.create.l HWIO_BIMC_MPU_XPU_PRT0_RACR0_ADDR A:0x32200
y.create.l HWIO_BIMC_MPU_XPU_PRT1_RACR0_ADDR A:0x32280
y.create.l HWIO_BIMC_MPU_XPU_PRT2_RACR0_ADDR A:0x32300
y.create.l HWIO_BIMC_MPU_XPU_PRT3_RACR0_ADDR A:0x32380
y.create.l HWIO_BIMC_MPU_XPU_PRT4_RACR0_ADDR A:0x32400
y.create.l HWIO_BIMC_MPU_XPU_PRT5_RACR0_ADDR A:0x32480
y.create.l HWIO_BIMC_MPU_XPU_PRT6_RACR0_ADDR A:0x32500
y.create.l HWIO_BIMC_MPU_XPU_PRT7_RACR0_ADDR A:0x32580
y.create.l HWIO_BIMC_MPU_XPU_PRT8_RACR0_ADDR A:0x32600
y.create.l HWIO_BIMC_MPU_XPU_PRT9_RACR0_ADDR A:0x32680
y.create.l HWIO_BIMC_MPU_XPU_PRT0_START0_ADDR A:0x32240
y.create.l HWIO_BIMC_MPU_XPU_PRT1_START0_ADDR A:0x322c0
y.create.l HWIO_BIMC_MPU_XPU_PRT2_START0_ADDR A:0x32340
y.create.l HWIO_BIMC_MPU_XPU_PRT3_START0_ADDR A:0x323c0
y.create.l HWIO_BIMC_MPU_XPU_PRT4_START0_ADDR A:0x32440
y.create.l HWIO_BIMC_MPU_XPU_PRT5_START0_ADDR A:0x324c0
y.create.l HWIO_BIMC_MPU_XPU_PRT6_START0_ADDR A:0x32540
y.create.l HWIO_BIMC_MPU_XPU_PRT7_START0_ADDR A:0x325c0
y.create.l HWIO_BIMC_MPU_XPU_PRT8_START0_ADDR A:0x32640
y.create.l HWIO_BIMC_MPU_XPU_PRT9_START0_ADDR A:0x326c0
y.create.l HWIO_BIMC_MPU_XPU_PRT0_END0_ADDR A:0x32248
y.create.l HWIO_BIMC_MPU_XPU_PRT1_END0_ADDR A:0x322c8
y.create.l HWIO_BIMC_MPU_XPU_PRT2_END0_ADDR A:0x32348
y.create.l HWIO_BIMC_MPU_XPU_PRT3_END0_ADDR A:0x323c8
y.create.l HWIO_BIMC_MPU_XPU_PRT4_END0_ADDR A:0x32448
y.create.l HWIO_BIMC_MPU_XPU_PRT5_END0_ADDR A:0x324c8
y.create.l HWIO_BIMC_MPU_XPU_PRT6_END0_ADDR A:0x32548
y.create.l HWIO_BIMC_MPU_XPU_PRT7_END0_ADDR A:0x325c8
y.create.l HWIO_BIMC_MPU_XPU_PRT8_END0_ADDR A:0x32648
y.create.l HWIO_BIMC_MPU_XPU_PRT9_END0_ADDR A:0x326c8
y.create.l HWIO_BIMC_MPU_XPU_PRT0_SCR_ADDR A:0x32250
y.create.l HWIO_BIMC_MPU_XPU_PRT1_SCR_ADDR A:0x322d0
y.create.l HWIO_BIMC_MPU_XPU_PRT2_SCR_ADDR A:0x32350
y.create.l HWIO_BIMC_MPU_XPU_PRT3_SCR_ADDR A:0x323d0
y.create.l HWIO_BIMC_MPU_XPU_PRT4_SCR_ADDR A:0x32450
y.create.l HWIO_BIMC_MPU_XPU_PRT5_SCR_ADDR A:0x324d0
y.create.l HWIO_BIMC_MPU_XPU_PRT6_SCR_ADDR A:0x32550
y.create.l HWIO_BIMC_MPU_XPU_PRT7_SCR_ADDR A:0x325d0
y.create.l HWIO_BIMC_MPU_XPU_PRT8_SCR_ADDR A:0x32650
y.create.l HWIO_BIMC_MPU_XPU_PRT9_SCR_ADDR A:0x326d0
y.create.l HWIO_BIMC_MPU_XPU_PRT0_MCR_ADDR A:0x32254
y.create.l HWIO_BIMC_MPU_XPU_PRT1_MCR_ADDR A:0x322d4
y.create.l HWIO_BIMC_MPU_XPU_PRT2_MCR_ADDR A:0x32354
y.create.l HWIO_BIMC_MPU_XPU_PRT3_MCR_ADDR A:0x323d4
y.create.l HWIO_BIMC_MPU_XPU_PRT4_MCR_ADDR A:0x32454
y.create.l HWIO_BIMC_MPU_XPU_PRT5_MCR_ADDR A:0x324d4
y.create.l HWIO_BIMC_MPU_XPU_PRT6_MCR_ADDR A:0x32554
y.create.l HWIO_BIMC_MPU_XPU_PRT7_MCR_ADDR A:0x325d4
y.create.l HWIO_BIMC_MPU_XPU_PRT8_MCR_ADDR A:0x32654
y.create.l HWIO_BIMC_MPU_XPU_PRT9_MCR_ADDR A:0x326d4
y.create.l HWIO_BIMC_MPU_XPU_PRT0_CNTL0_ADDR A:0x32258
y.create.l HWIO_BIMC_MPU_XPU_PRT1_CNTL0_ADDR A:0x322d8
y.create.l HWIO_BIMC_MPU_XPU_PRT2_CNTL0_ADDR A:0x32358
y.create.l HWIO_BIMC_MPU_XPU_PRT3_CNTL0_ADDR A:0x323d8
y.create.l HWIO_BIMC_MPU_XPU_PRT4_CNTL0_ADDR A:0x32458
y.create.l HWIO_BIMC_MPU_XPU_PRT5_CNTL0_ADDR A:0x324d8
y.create.l HWIO_BIMC_MPU_XPU_PRT6_CNTL0_ADDR A:0x32558
y.create.l HWIO_BIMC_MPU_XPU_PRT7_CNTL0_ADDR A:0x325d8
y.create.l HWIO_BIMC_MPU_XPU_PRT8_CNTL0_ADDR A:0x32658
y.create.l HWIO_BIMC_MPU_XPU_PRT9_CNTL0_ADDR A:0x326d8
y.create.l HWIO_BIMC_MPU_XPU_PRT0_CNTL1_ADDR A:0x3225c
y.create.l HWIO_BIMC_MPU_XPU_PRT1_CNTL1_ADDR A:0x322dc
y.create.l HWIO_BIMC_MPU_XPU_PRT2_CNTL1_ADDR A:0x3235c
y.create.l HWIO_BIMC_MPU_XPU_PRT3_CNTL1_ADDR A:0x323dc
y.create.l HWIO_BIMC_MPU_XPU_PRT4_CNTL1_ADDR A:0x3245c
y.create.l HWIO_BIMC_MPU_XPU_PRT5_CNTL1_ADDR A:0x324dc
y.create.l HWIO_BIMC_MPU_XPU_PRT6_CNTL1_ADDR A:0x3255c
y.create.l HWIO_BIMC_MPU_XPU_PRT7_CNTL1_ADDR A:0x325dc
y.create.l HWIO_BIMC_MPU_XPU_PRT8_CNTL1_ADDR A:0x3265c
y.create.l HWIO_BIMC_MPU_XPU_PRT9_CNTL1_ADDR A:0x326dc
y.create.l HWIO_BLSP1_BLSP_BAM_BAM_CTRL_ADDR A:0x7884000
y.create.l HWIO_BLSP1_BLSP_BAM_BAM_TIMER_ADDR A:0x7884040
y.create.l HWIO_BLSP1_BLSP_BAM_BAM_TIMER_CTRL_ADDR A:0x7884044
y.create.l HWIO_BLSP1_BLSP_BAM_BAM_DESC_CNT_TRSHLD_ADDR A:0x7884008
y.create.l HWIO_BLSP1_BLSP_BAM_BAM_IRQ_STTS_ADDR A:0x7884014
y.create.l HWIO_BLSP1_BLSP_BAM_BAM_IRQ_CLR_ADDR A:0x7884018
y.create.l HWIO_BLSP1_BLSP_BAM_BAM_IRQ_EN_ADDR A:0x788401c
y.create.l HWIO_BLSP1_BLSP_BAM_BAM_CNFG_BITS_ADDR A:0x788407c
y.create.l HWIO_BLSP1_BLSP_BAM_BAM_REVISION_ADDR A:0x7885000
y.create.l HWIO_BLSP1_BLSP_BAM_BAM_SW_VERSION_ADDR A:0x7885004
y.create.l HWIO_BLSP1_BLSP_BAM_BAM_NUM_PIPES_ADDR A:0x7885008
y.create.l HWIO_BLSP1_BLSP_BAM_BAM_TEST_BUS_SEL_ADDR A:0x7885010
y.create.l HWIO_BLSP1_BLSP_BAM_BAM_TEST_BUS_REG_ADDR A:0x7885014
y.create.l HWIO_BLSP1_BLSP_BAM_BAM_AHB_MASTER_ERR_CTRLS_ADDR A:0x7885024
y.create.l HWIO_BLSP1_BLSP_BAM_BAM_AHB_MASTER_ERR_ADDR_ADDR A:0x7885028
y.create.l HWIO_BLSP1_BLSP_BAM_BAM_AHB_MASTER_ERR_DATA_ADDR A:0x788502c
y.create.l HWIO_BLSP1_BLSP_BAM_BAM_AHB_MASTER_ERR_ADDR_LSB_ADDR A:0x7885100
y.create.l HWIO_BLSP1_BLSP_BAM_BAM_AHB_MASTER_ERR_ADDR_MSB_ADDR A:0x7885104
y.create.l HWIO_BLSP1_BLSP_BAM_BAM_TRUST_REG_ADDR A:0x7886000
y.create.l HWIO_BLSP1_BLSP_BAM_BAM_P_TRUST_REG0_ADDR A:0x7886020
y.create.l HWIO_BLSP1_BLSP_BAM_BAM_P_TRUST_REG1_ADDR A:0x7886024
y.create.l HWIO_BLSP1_BLSP_BAM_BAM_P_TRUST_REG2_ADDR A:0x7886028
y.create.l HWIO_BLSP1_BLSP_BAM_BAM_P_TRUST_REG3_ADDR A:0x788602c
y.create.l HWIO_BLSP1_BLSP_BAM_BAM_P_TRUST_REG4_ADDR A:0x7886030
y.create.l HWIO_BLSP1_BLSP_BAM_BAM_P_TRUST_REG5_ADDR A:0x7886034
y.create.l HWIO_BLSP1_BLSP_BAM_BAM_P_TRUST_REG6_ADDR A:0x7886038
y.create.l HWIO_BLSP1_BLSP_BAM_BAM_P_TRUST_REG7_ADDR A:0x788603c
y.create.l HWIO_BLSP1_BLSP_BAM_BAM_P_TRUST_REG8_ADDR A:0x7886040
y.create.l HWIO_BLSP1_BLSP_BAM_BAM_P_TRUST_REG9_ADDR A:0x7886044
y.create.l HWIO_BLSP1_BLSP_BAM_BAM_IRQ_SRCS_EE0_ADDR A:0x7887000
y.create.l HWIO_BLSP1_BLSP_BAM_BAM_IRQ_SRCS_EE1_ADDR A:0x7888000
y.create.l HWIO_BLSP1_BLSP_BAM_BAM_IRQ_SRCS_EE2_ADDR A:0x7889000
y.create.l HWIO_BLSP1_BLSP_BAM_BAM_IRQ_SRCS_EE3_ADDR A:0x788a000
y.create.l HWIO_BLSP1_BLSP_BAM_BAM_IRQ_SRCS_EE4_ADDR A:0x788b000
y.create.l HWIO_BLSP1_BLSP_BAM_BAM_IRQ_SRCS_EE5_ADDR A:0x788c000
y.create.l HWIO_BLSP1_BLSP_BAM_BAM_IRQ_SRCS_EE6_ADDR A:0x788d000
y.create.l HWIO_BLSP1_BLSP_BAM_BAM_IRQ_SRCS_EE7_ADDR A:0x788e000
y.create.l HWIO_BLSP1_BLSP_BAM_BAM_IRQ_SRCS_MSK_EE0_ADDR A:0x7887004
y.create.l HWIO_BLSP1_BLSP_BAM_BAM_IRQ_SRCS_MSK_EE1_ADDR A:0x7888004
y.create.l HWIO_BLSP1_BLSP_BAM_BAM_IRQ_SRCS_MSK_EE2_ADDR A:0x7889004
y.create.l HWIO_BLSP1_BLSP_BAM_BAM_IRQ_SRCS_MSK_EE3_ADDR A:0x788a004
y.create.l HWIO_BLSP1_BLSP_BAM_BAM_IRQ_SRCS_MSK_EE4_ADDR A:0x788b004
y.create.l HWIO_BLSP1_BLSP_BAM_BAM_IRQ_SRCS_MSK_EE5_ADDR A:0x788c004
y.create.l HWIO_BLSP1_BLSP_BAM_BAM_IRQ_SRCS_MSK_EE6_ADDR A:0x788d004
y.create.l HWIO_BLSP1_BLSP_BAM_BAM_IRQ_SRCS_MSK_EE7_ADDR A:0x788e004
y.create.l HWIO_BLSP1_BLSP_BAM_BAM_IRQ_SRCS_UNMASKED_EE0_ADDR A:0x7887008
y.create.l HWIO_BLSP1_BLSP_BAM_BAM_IRQ_SRCS_UNMASKED_EE1_ADDR A:0x7888008
y.create.l HWIO_BLSP1_BLSP_BAM_BAM_IRQ_SRCS_UNMASKED_EE2_ADDR A:0x7889008
y.create.l HWIO_BLSP1_BLSP_BAM_BAM_IRQ_SRCS_UNMASKED_EE3_ADDR A:0x788a008
y.create.l HWIO_BLSP1_BLSP_BAM_BAM_IRQ_SRCS_UNMASKED_EE4_ADDR A:0x788b008
y.create.l HWIO_BLSP1_BLSP_BAM_BAM_IRQ_SRCS_UNMASKED_EE5_ADDR A:0x788c008
y.create.l HWIO_BLSP1_BLSP_BAM_BAM_IRQ_SRCS_UNMASKED_EE6_ADDR A:0x788d008
y.create.l HWIO_BLSP1_BLSP_BAM_BAM_IRQ_SRCS_UNMASKED_EE7_ADDR A:0x788e008
y.create.l HWIO_BLSP1_BLSP_BAM_BAM_PIPE_ATTR_EE0_ADDR A:0x788700c
y.create.l HWIO_BLSP1_BLSP_BAM_BAM_PIPE_ATTR_EE1_ADDR A:0x788800c
y.create.l HWIO_BLSP1_BLSP_BAM_BAM_PIPE_ATTR_EE2_ADDR A:0x788900c
y.create.l HWIO_BLSP1_BLSP_BAM_BAM_PIPE_ATTR_EE3_ADDR A:0x788a00c
y.create.l HWIO_BLSP1_BLSP_BAM_BAM_PIPE_ATTR_EE4_ADDR A:0x788b00c
y.create.l HWIO_BLSP1_BLSP_BAM_BAM_PIPE_ATTR_EE5_ADDR A:0x788c00c
y.create.l HWIO_BLSP1_BLSP_BAM_BAM_PIPE_ATTR_EE6_ADDR A:0x788d00c
y.create.l HWIO_BLSP1_BLSP_BAM_BAM_PIPE_ATTR_EE7_ADDR A:0x788e00c
y.create.l HWIO_BLSP1_BLSP_BAM_BAM_IRQ_SRCS_ADDR A:0x7887010
y.create.l HWIO_BLSP1_BLSP_BAM_BAM_IRQ_SRCS_MSK_ADDR A:0x7887014
y.create.l HWIO_BLSP1_BLSP_BAM_BAM_IRQ_SRCS_UNMASKED_ADDR A:0x7887018
y.create.l HWIO_BLSP1_BLSP_BAM_BAM_P_CTRL0_ADDR A:0x7897000
y.create.l HWIO_BLSP1_BLSP_BAM_BAM_P_CTRL1_ADDR A:0x7898000
y.create.l HWIO_BLSP1_BLSP_BAM_BAM_P_CTRL2_ADDR A:0x7899000
y.create.l HWIO_BLSP1_BLSP_BAM_BAM_P_CTRL3_ADDR A:0x789a000
y.create.l HWIO_BLSP1_BLSP_BAM_BAM_P_CTRL4_ADDR A:0x789b000
y.create.l HWIO_BLSP1_BLSP_BAM_BAM_P_CTRL5_ADDR A:0x789c000
y.create.l HWIO_BLSP1_BLSP_BAM_BAM_P_CTRL6_ADDR A:0x789d000
y.create.l HWIO_BLSP1_BLSP_BAM_BAM_P_CTRL7_ADDR A:0x789e000
y.create.l HWIO_BLSP1_BLSP_BAM_BAM_P_CTRL8_ADDR A:0x789f000
y.create.l HWIO_BLSP1_BLSP_BAM_BAM_P_CTRL9_ADDR A:0x78a0000
y.create.l HWIO_BLSP1_BLSP_BAM_BAM_P_RST0_ADDR A:0x7897004
y.create.l HWIO_BLSP1_BLSP_BAM_BAM_P_RST1_ADDR A:0x7898004
y.create.l HWIO_BLSP1_BLSP_BAM_BAM_P_RST2_ADDR A:0x7899004
y.create.l HWIO_BLSP1_BLSP_BAM_BAM_P_RST3_ADDR A:0x789a004
y.create.l HWIO_BLSP1_BLSP_BAM_BAM_P_RST4_ADDR A:0x789b004
y.create.l HWIO_BLSP1_BLSP_BAM_BAM_P_RST5_ADDR A:0x789c004
y.create.l HWIO_BLSP1_BLSP_BAM_BAM_P_RST6_ADDR A:0x789d004
y.create.l HWIO_BLSP1_BLSP_BAM_BAM_P_RST7_ADDR A:0x789e004
y.create.l HWIO_BLSP1_BLSP_BAM_BAM_P_RST8_ADDR A:0x789f004
y.create.l HWIO_BLSP1_BLSP_BAM_BAM_P_RST9_ADDR A:0x78a0004
y.create.l HWIO_BLSP1_BLSP_BAM_BAM_P_HALT0_ADDR A:0x7897008
y.create.l HWIO_BLSP1_BLSP_BAM_BAM_P_HALT1_ADDR A:0x7898008
y.create.l HWIO_BLSP1_BLSP_BAM_BAM_P_HALT2_ADDR A:0x7899008
y.create.l HWIO_BLSP1_BLSP_BAM_BAM_P_HALT3_ADDR A:0x789a008
y.create.l HWIO_BLSP1_BLSP_BAM_BAM_P_HALT4_ADDR A:0x789b008
y.create.l HWIO_BLSP1_BLSP_BAM_BAM_P_HALT5_ADDR A:0x789c008
y.create.l HWIO_BLSP1_BLSP_BAM_BAM_P_HALT6_ADDR A:0x789d008
y.create.l HWIO_BLSP1_BLSP_BAM_BAM_P_HALT7_ADDR A:0x789e008
y.create.l HWIO_BLSP1_BLSP_BAM_BAM_P_HALT8_ADDR A:0x789f008
y.create.l HWIO_BLSP1_BLSP_BAM_BAM_P_HALT9_ADDR A:0x78a0008
y.create.l HWIO_BLSP1_BLSP_BAM_BAM_P_IRQ_STTS0_ADDR A:0x7897010
y.create.l HWIO_BLSP1_BLSP_BAM_BAM_P_IRQ_STTS1_ADDR A:0x7898010
y.create.l HWIO_BLSP1_BLSP_BAM_BAM_P_IRQ_STTS2_ADDR A:0x7899010
y.create.l HWIO_BLSP1_BLSP_BAM_BAM_P_IRQ_STTS3_ADDR A:0x789a010
y.create.l HWIO_BLSP1_BLSP_BAM_BAM_P_IRQ_STTS4_ADDR A:0x789b010
y.create.l HWIO_BLSP1_BLSP_BAM_BAM_P_IRQ_STTS5_ADDR A:0x789c010
y.create.l HWIO_BLSP1_BLSP_BAM_BAM_P_IRQ_STTS6_ADDR A:0x789d010
y.create.l HWIO_BLSP1_BLSP_BAM_BAM_P_IRQ_STTS7_ADDR A:0x789e010
y.create.l HWIO_BLSP1_BLSP_BAM_BAM_P_IRQ_STTS8_ADDR A:0x789f010
y.create.l HWIO_BLSP1_BLSP_BAM_BAM_P_IRQ_STTS9_ADDR A:0x78a0010
y.create.l HWIO_BLSP1_BLSP_BAM_BAM_P_IRQ_CLR0_ADDR A:0x7897014
y.create.l HWIO_BLSP1_BLSP_BAM_BAM_P_IRQ_CLR1_ADDR A:0x7898014
y.create.l HWIO_BLSP1_BLSP_BAM_BAM_P_IRQ_CLR2_ADDR A:0x7899014
y.create.l HWIO_BLSP1_BLSP_BAM_BAM_P_IRQ_CLR3_ADDR A:0x789a014
y.create.l HWIO_BLSP1_BLSP_BAM_BAM_P_IRQ_CLR4_ADDR A:0x789b014
y.create.l HWIO_BLSP1_BLSP_BAM_BAM_P_IRQ_CLR5_ADDR A:0x789c014
y.create.l HWIO_BLSP1_BLSP_BAM_BAM_P_IRQ_CLR6_ADDR A:0x789d014
y.create.l HWIO_BLSP1_BLSP_BAM_BAM_P_IRQ_CLR7_ADDR A:0x789e014
y.create.l HWIO_BLSP1_BLSP_BAM_BAM_P_IRQ_CLR8_ADDR A:0x789f014
y.create.l HWIO_BLSP1_BLSP_BAM_BAM_P_IRQ_CLR9_ADDR A:0x78a0014
y.create.l HWIO_BLSP1_BLSP_BAM_BAM_P_IRQ_EN0_ADDR A:0x7897018
y.create.l HWIO_BLSP1_BLSP_BAM_BAM_P_IRQ_EN1_ADDR A:0x7898018
y.create.l HWIO_BLSP1_BLSP_BAM_BAM_P_IRQ_EN2_ADDR A:0x7899018
y.create.l HWIO_BLSP1_BLSP_BAM_BAM_P_IRQ_EN3_ADDR A:0x789a018
y.create.l HWIO_BLSP1_BLSP_BAM_BAM_P_IRQ_EN4_ADDR A:0x789b018
y.create.l HWIO_BLSP1_BLSP_BAM_BAM_P_IRQ_EN5_ADDR A:0x789c018
y.create.l HWIO_BLSP1_BLSP_BAM_BAM_P_IRQ_EN6_ADDR A:0x789d018
y.create.l HWIO_BLSP1_BLSP_BAM_BAM_P_IRQ_EN7_ADDR A:0x789e018
y.create.l HWIO_BLSP1_BLSP_BAM_BAM_P_IRQ_EN8_ADDR A:0x789f018
y.create.l HWIO_BLSP1_BLSP_BAM_BAM_P_IRQ_EN9_ADDR A:0x78a0018
y.create.l HWIO_BLSP1_BLSP_BAM_BAM_P_TIMER0_ADDR A:0x789701c
y.create.l HWIO_BLSP1_BLSP_BAM_BAM_P_TIMER1_ADDR A:0x789801c
y.create.l HWIO_BLSP1_BLSP_BAM_BAM_P_TIMER2_ADDR A:0x789901c
y.create.l HWIO_BLSP1_BLSP_BAM_BAM_P_TIMER3_ADDR A:0x789a01c
y.create.l HWIO_BLSP1_BLSP_BAM_BAM_P_TIMER4_ADDR A:0x789b01c
y.create.l HWIO_BLSP1_BLSP_BAM_BAM_P_TIMER5_ADDR A:0x789c01c
y.create.l HWIO_BLSP1_BLSP_BAM_BAM_P_TIMER6_ADDR A:0x789d01c
y.create.l HWIO_BLSP1_BLSP_BAM_BAM_P_TIMER7_ADDR A:0x789e01c
y.create.l HWIO_BLSP1_BLSP_BAM_BAM_P_TIMER8_ADDR A:0x789f01c
y.create.l HWIO_BLSP1_BLSP_BAM_BAM_P_TIMER9_ADDR A:0x78a001c
y.create.l HWIO_BLSP1_BLSP_BAM_BAM_P_TIMER_CTRL0_ADDR A:0x7897020
y.create.l HWIO_BLSP1_BLSP_BAM_BAM_P_TIMER_CTRL1_ADDR A:0x7898020
y.create.l HWIO_BLSP1_BLSP_BAM_BAM_P_TIMER_CTRL2_ADDR A:0x7899020
y.create.l HWIO_BLSP1_BLSP_BAM_BAM_P_TIMER_CTRL3_ADDR A:0x789a020
y.create.l HWIO_BLSP1_BLSP_BAM_BAM_P_TIMER_CTRL4_ADDR A:0x789b020
y.create.l HWIO_BLSP1_BLSP_BAM_BAM_P_TIMER_CTRL5_ADDR A:0x789c020
y.create.l HWIO_BLSP1_BLSP_BAM_BAM_P_TIMER_CTRL6_ADDR A:0x789d020
y.create.l HWIO_BLSP1_BLSP_BAM_BAM_P_TIMER_CTRL7_ADDR A:0x789e020
y.create.l HWIO_BLSP1_BLSP_BAM_BAM_P_TIMER_CTRL8_ADDR A:0x789f020
y.create.l HWIO_BLSP1_BLSP_BAM_BAM_P_TIMER_CTRL9_ADDR A:0x78a0020
y.create.l HWIO_BLSP1_BLSP_BAM_BAM_P_PRDCR_SDBND0_ADDR A:0x7897024
y.create.l HWIO_BLSP1_BLSP_BAM_BAM_P_PRDCR_SDBND1_ADDR A:0x7898024
y.create.l HWIO_BLSP1_BLSP_BAM_BAM_P_PRDCR_SDBND2_ADDR A:0x7899024
y.create.l HWIO_BLSP1_BLSP_BAM_BAM_P_PRDCR_SDBND3_ADDR A:0x789a024
y.create.l HWIO_BLSP1_BLSP_BAM_BAM_P_PRDCR_SDBND4_ADDR A:0x789b024
y.create.l HWIO_BLSP1_BLSP_BAM_BAM_P_PRDCR_SDBND5_ADDR A:0x789c024
y.create.l HWIO_BLSP1_BLSP_BAM_BAM_P_PRDCR_SDBND6_ADDR A:0x789d024
y.create.l HWIO_BLSP1_BLSP_BAM_BAM_P_PRDCR_SDBND7_ADDR A:0x789e024
y.create.l HWIO_BLSP1_BLSP_BAM_BAM_P_PRDCR_SDBND8_ADDR A:0x789f024
y.create.l HWIO_BLSP1_BLSP_BAM_BAM_P_PRDCR_SDBND9_ADDR A:0x78a0024
y.create.l HWIO_BLSP1_BLSP_BAM_BAM_P_CNSMR_SDBND0_ADDR A:0x7897028
y.create.l HWIO_BLSP1_BLSP_BAM_BAM_P_CNSMR_SDBND1_ADDR A:0x7898028
y.create.l HWIO_BLSP1_BLSP_BAM_BAM_P_CNSMR_SDBND2_ADDR A:0x7899028
y.create.l HWIO_BLSP1_BLSP_BAM_BAM_P_CNSMR_SDBND3_ADDR A:0x789a028
y.create.l HWIO_BLSP1_BLSP_BAM_BAM_P_CNSMR_SDBND4_ADDR A:0x789b028
y.create.l HWIO_BLSP1_BLSP_BAM_BAM_P_CNSMR_SDBND5_ADDR A:0x789c028
y.create.l HWIO_BLSP1_BLSP_BAM_BAM_P_CNSMR_SDBND6_ADDR A:0x789d028
y.create.l HWIO_BLSP1_BLSP_BAM_BAM_P_CNSMR_SDBND7_ADDR A:0x789e028
y.create.l HWIO_BLSP1_BLSP_BAM_BAM_P_CNSMR_SDBND8_ADDR A:0x789f028
y.create.l HWIO_BLSP1_BLSP_BAM_BAM_P_CNSMR_SDBND9_ADDR A:0x78a0028
y.create.l HWIO_BLSP1_BLSP_BAM_BAM_P_SW_OFSTS0_ADDR A:0x7897800
y.create.l HWIO_BLSP1_BLSP_BAM_BAM_P_SW_OFSTS1_ADDR A:0x7898800
y.create.l HWIO_BLSP1_BLSP_BAM_BAM_P_SW_OFSTS2_ADDR A:0x7899800
y.create.l HWIO_BLSP1_BLSP_BAM_BAM_P_SW_OFSTS3_ADDR A:0x789a800
y.create.l HWIO_BLSP1_BLSP_BAM_BAM_P_SW_OFSTS4_ADDR A:0x789b800
y.create.l HWIO_BLSP1_BLSP_BAM_BAM_P_SW_OFSTS5_ADDR A:0x789c800
y.create.l HWIO_BLSP1_BLSP_BAM_BAM_P_SW_OFSTS6_ADDR A:0x789d800
y.create.l HWIO_BLSP1_BLSP_BAM_BAM_P_SW_OFSTS7_ADDR A:0x789e800
y.create.l HWIO_BLSP1_BLSP_BAM_BAM_P_SW_OFSTS8_ADDR A:0x789f800
y.create.l HWIO_BLSP1_BLSP_BAM_BAM_P_SW_OFSTS9_ADDR A:0x78a0800
y.create.l HWIO_BLSP1_BLSP_BAM_BAM_P_AU_PSM_CNTXT_1_0_ADDR A:0x7897804
y.create.l HWIO_BLSP1_BLSP_BAM_BAM_P_AU_PSM_CNTXT_1_1_ADDR A:0x7898804
y.create.l HWIO_BLSP1_BLSP_BAM_BAM_P_AU_PSM_CNTXT_1_2_ADDR A:0x7899804
y.create.l HWIO_BLSP1_BLSP_BAM_BAM_P_AU_PSM_CNTXT_1_3_ADDR A:0x789a804
y.create.l HWIO_BLSP1_BLSP_BAM_BAM_P_AU_PSM_CNTXT_1_4_ADDR A:0x789b804
y.create.l HWIO_BLSP1_BLSP_BAM_BAM_P_AU_PSM_CNTXT_1_5_ADDR A:0x789c804
y.create.l HWIO_BLSP1_BLSP_BAM_BAM_P_AU_PSM_CNTXT_1_6_ADDR A:0x789d804
y.create.l HWIO_BLSP1_BLSP_BAM_BAM_P_AU_PSM_CNTXT_1_7_ADDR A:0x789e804
y.create.l HWIO_BLSP1_BLSP_BAM_BAM_P_AU_PSM_CNTXT_1_8_ADDR A:0x789f804
y.create.l HWIO_BLSP1_BLSP_BAM_BAM_P_AU_PSM_CNTXT_1_9_ADDR A:0x78a0804
y.create.l HWIO_BLSP1_BLSP_BAM_BAM_P_PSM_CNTXT_2_0_ADDR A:0x7897808
y.create.l HWIO_BLSP1_BLSP_BAM_BAM_P_PSM_CNTXT_2_1_ADDR A:0x7898808
y.create.l HWIO_BLSP1_BLSP_BAM_BAM_P_PSM_CNTXT_2_2_ADDR A:0x7899808
y.create.l HWIO_BLSP1_BLSP_BAM_BAM_P_PSM_CNTXT_2_3_ADDR A:0x789a808
y.create.l HWIO_BLSP1_BLSP_BAM_BAM_P_PSM_CNTXT_2_4_ADDR A:0x789b808
y.create.l HWIO_BLSP1_BLSP_BAM_BAM_P_PSM_CNTXT_2_5_ADDR A:0x789c808
y.create.l HWIO_BLSP1_BLSP_BAM_BAM_P_PSM_CNTXT_2_6_ADDR A:0x789d808
y.create.l HWIO_BLSP1_BLSP_BAM_BAM_P_PSM_CNTXT_2_7_ADDR A:0x789e808
y.create.l HWIO_BLSP1_BLSP_BAM_BAM_P_PSM_CNTXT_2_8_ADDR A:0x789f808
y.create.l HWIO_BLSP1_BLSP_BAM_BAM_P_PSM_CNTXT_2_9_ADDR A:0x78a0808
y.create.l HWIO_BLSP1_BLSP_BAM_BAM_P_PSM_CNTXT_3_0_ADDR A:0x789780c
y.create.l HWIO_BLSP1_BLSP_BAM_BAM_P_PSM_CNTXT_3_1_ADDR A:0x789880c
y.create.l HWIO_BLSP1_BLSP_BAM_BAM_P_PSM_CNTXT_3_2_ADDR A:0x789980c
y.create.l HWIO_BLSP1_BLSP_BAM_BAM_P_PSM_CNTXT_3_3_ADDR A:0x789a80c
y.create.l HWIO_BLSP1_BLSP_BAM_BAM_P_PSM_CNTXT_3_4_ADDR A:0x789b80c
y.create.l HWIO_BLSP1_BLSP_BAM_BAM_P_PSM_CNTXT_3_5_ADDR A:0x789c80c
y.create.l HWIO_BLSP1_BLSP_BAM_BAM_P_PSM_CNTXT_3_6_ADDR A:0x789d80c
y.create.l HWIO_BLSP1_BLSP_BAM_BAM_P_PSM_CNTXT_3_7_ADDR A:0x789e80c
y.create.l HWIO_BLSP1_BLSP_BAM_BAM_P_PSM_CNTXT_3_8_ADDR A:0x789f80c
y.create.l HWIO_BLSP1_BLSP_BAM_BAM_P_PSM_CNTXT_3_9_ADDR A:0x78a080c
y.create.l HWIO_BLSP1_BLSP_BAM_BAM_P_PSM_CNTXT_4_0_ADDR A:0x7897810
y.create.l HWIO_BLSP1_BLSP_BAM_BAM_P_PSM_CNTXT_4_1_ADDR A:0x7898810
y.create.l HWIO_BLSP1_BLSP_BAM_BAM_P_PSM_CNTXT_4_2_ADDR A:0x7899810
y.create.l HWIO_BLSP1_BLSP_BAM_BAM_P_PSM_CNTXT_4_3_ADDR A:0x789a810
y.create.l HWIO_BLSP1_BLSP_BAM_BAM_P_PSM_CNTXT_4_4_ADDR A:0x789b810
y.create.l HWIO_BLSP1_BLSP_BAM_BAM_P_PSM_CNTXT_4_5_ADDR A:0x789c810
y.create.l HWIO_BLSP1_BLSP_BAM_BAM_P_PSM_CNTXT_4_6_ADDR A:0x789d810
y.create.l HWIO_BLSP1_BLSP_BAM_BAM_P_PSM_CNTXT_4_7_ADDR A:0x789e810
y.create.l HWIO_BLSP1_BLSP_BAM_BAM_P_PSM_CNTXT_4_8_ADDR A:0x789f810
y.create.l HWIO_BLSP1_BLSP_BAM_BAM_P_PSM_CNTXT_4_9_ADDR A:0x78a0810
y.create.l HWIO_BLSP1_BLSP_BAM_BAM_P_PSM_CNTXT_5_0_ADDR A:0x7897814
y.create.l HWIO_BLSP1_BLSP_BAM_BAM_P_PSM_CNTXT_5_1_ADDR A:0x7898814
y.create.l HWIO_BLSP1_BLSP_BAM_BAM_P_PSM_CNTXT_5_2_ADDR A:0x7899814
y.create.l HWIO_BLSP1_BLSP_BAM_BAM_P_PSM_CNTXT_5_3_ADDR A:0x789a814
y.create.l HWIO_BLSP1_BLSP_BAM_BAM_P_PSM_CNTXT_5_4_ADDR A:0x789b814
y.create.l HWIO_BLSP1_BLSP_BAM_BAM_P_PSM_CNTXT_5_5_ADDR A:0x789c814
y.create.l HWIO_BLSP1_BLSP_BAM_BAM_P_PSM_CNTXT_5_6_ADDR A:0x789d814
y.create.l HWIO_BLSP1_BLSP_BAM_BAM_P_PSM_CNTXT_5_7_ADDR A:0x789e814
y.create.l HWIO_BLSP1_BLSP_BAM_BAM_P_PSM_CNTXT_5_8_ADDR A:0x789f814
y.create.l HWIO_BLSP1_BLSP_BAM_BAM_P_PSM_CNTXT_5_9_ADDR A:0x78a0814
y.create.l HWIO_BLSP1_BLSP_BAM_BAM_P_EVNT_REG0_ADDR A:0x7897818
y.create.l HWIO_BLSP1_BLSP_BAM_BAM_P_EVNT_REG1_ADDR A:0x7898818
y.create.l HWIO_BLSP1_BLSP_BAM_BAM_P_EVNT_REG2_ADDR A:0x7899818
y.create.l HWIO_BLSP1_BLSP_BAM_BAM_P_EVNT_REG3_ADDR A:0x789a818
y.create.l HWIO_BLSP1_BLSP_BAM_BAM_P_EVNT_REG4_ADDR A:0x789b818
y.create.l HWIO_BLSP1_BLSP_BAM_BAM_P_EVNT_REG5_ADDR A:0x789c818
y.create.l HWIO_BLSP1_BLSP_BAM_BAM_P_EVNT_REG6_ADDR A:0x789d818
y.create.l HWIO_BLSP1_BLSP_BAM_BAM_P_EVNT_REG7_ADDR A:0x789e818
y.create.l HWIO_BLSP1_BLSP_BAM_BAM_P_EVNT_REG8_ADDR A:0x789f818
y.create.l HWIO_BLSP1_BLSP_BAM_BAM_P_EVNT_REG9_ADDR A:0x78a0818
y.create.l HWIO_BLSP1_BLSP_BAM_BAM_P_DESC_FIFO_ADDR0_ADDR A:0x789781c
y.create.l HWIO_BLSP1_BLSP_BAM_BAM_P_DESC_FIFO_ADDR1_ADDR A:0x789881c
y.create.l HWIO_BLSP1_BLSP_BAM_BAM_P_DESC_FIFO_ADDR2_ADDR A:0x789981c
y.create.l HWIO_BLSP1_BLSP_BAM_BAM_P_DESC_FIFO_ADDR3_ADDR A:0x789a81c
y.create.l HWIO_BLSP1_BLSP_BAM_BAM_P_DESC_FIFO_ADDR4_ADDR A:0x789b81c
y.create.l HWIO_BLSP1_BLSP_BAM_BAM_P_DESC_FIFO_ADDR5_ADDR A:0x789c81c
y.create.l HWIO_BLSP1_BLSP_BAM_BAM_P_DESC_FIFO_ADDR6_ADDR A:0x789d81c
y.create.l HWIO_BLSP1_BLSP_BAM_BAM_P_DESC_FIFO_ADDR7_ADDR A:0x789e81c
y.create.l HWIO_BLSP1_BLSP_BAM_BAM_P_DESC_FIFO_ADDR8_ADDR A:0x789f81c
y.create.l HWIO_BLSP1_BLSP_BAM_BAM_P_DESC_FIFO_ADDR9_ADDR A:0x78a081c
y.create.l HWIO_BLSP1_BLSP_BAM_BAM_P_FIFO_SIZES0_ADDR A:0x7897820
y.create.l HWIO_BLSP1_BLSP_BAM_BAM_P_FIFO_SIZES1_ADDR A:0x7898820
y.create.l HWIO_BLSP1_BLSP_BAM_BAM_P_FIFO_SIZES2_ADDR A:0x7899820
y.create.l HWIO_BLSP1_BLSP_BAM_BAM_P_FIFO_SIZES3_ADDR A:0x789a820
y.create.l HWIO_BLSP1_BLSP_BAM_BAM_P_FIFO_SIZES4_ADDR A:0x789b820
y.create.l HWIO_BLSP1_BLSP_BAM_BAM_P_FIFO_SIZES5_ADDR A:0x789c820
y.create.l HWIO_BLSP1_BLSP_BAM_BAM_P_FIFO_SIZES6_ADDR A:0x789d820
y.create.l HWIO_BLSP1_BLSP_BAM_BAM_P_FIFO_SIZES7_ADDR A:0x789e820
y.create.l HWIO_BLSP1_BLSP_BAM_BAM_P_FIFO_SIZES8_ADDR A:0x789f820
y.create.l HWIO_BLSP1_BLSP_BAM_BAM_P_FIFO_SIZES9_ADDR A:0x78a0820
y.create.l HWIO_BLSP1_BLSP_BAM_BAM_P_DATA_FIFO_ADDR0_ADDR A:0x7897824
y.create.l HWIO_BLSP1_BLSP_BAM_BAM_P_DATA_FIFO_ADDR1_ADDR A:0x7898824
y.create.l HWIO_BLSP1_BLSP_BAM_BAM_P_DATA_FIFO_ADDR2_ADDR A:0x7899824
y.create.l HWIO_BLSP1_BLSP_BAM_BAM_P_DATA_FIFO_ADDR3_ADDR A:0x789a824
y.create.l HWIO_BLSP1_BLSP_BAM_BAM_P_DATA_FIFO_ADDR4_ADDR A:0x789b824
y.create.l HWIO_BLSP1_BLSP_BAM_BAM_P_DATA_FIFO_ADDR5_ADDR A:0x789c824
y.create.l HWIO_BLSP1_BLSP_BAM_BAM_P_DATA_FIFO_ADDR6_ADDR A:0x789d824
y.create.l HWIO_BLSP1_BLSP_BAM_BAM_P_DATA_FIFO_ADDR7_ADDR A:0x789e824
y.create.l HWIO_BLSP1_BLSP_BAM_BAM_P_DATA_FIFO_ADDR8_ADDR A:0x789f824
y.create.l HWIO_BLSP1_BLSP_BAM_BAM_P_DATA_FIFO_ADDR9_ADDR A:0x78a0824
y.create.l HWIO_BLSP1_BLSP_BAM_BAM_P_EVNT_GEN_TRSHLD0_ADDR A:0x7897828
y.create.l HWIO_BLSP1_BLSP_BAM_BAM_P_EVNT_GEN_TRSHLD1_ADDR A:0x7898828
y.create.l HWIO_BLSP1_BLSP_BAM_BAM_P_EVNT_GEN_TRSHLD2_ADDR A:0x7899828
y.create.l HWIO_BLSP1_BLSP_BAM_BAM_P_EVNT_GEN_TRSHLD3_ADDR A:0x789a828
y.create.l HWIO_BLSP1_BLSP_BAM_BAM_P_EVNT_GEN_TRSHLD4_ADDR A:0x789b828
y.create.l HWIO_BLSP1_BLSP_BAM_BAM_P_EVNT_GEN_TRSHLD5_ADDR A:0x789c828
y.create.l HWIO_BLSP1_BLSP_BAM_BAM_P_EVNT_GEN_TRSHLD6_ADDR A:0x789d828
y.create.l HWIO_BLSP1_BLSP_BAM_BAM_P_EVNT_GEN_TRSHLD7_ADDR A:0x789e828
y.create.l HWIO_BLSP1_BLSP_BAM_BAM_P_EVNT_GEN_TRSHLD8_ADDR A:0x789f828
y.create.l HWIO_BLSP1_BLSP_BAM_BAM_P_EVNT_GEN_TRSHLD9_ADDR A:0x78a0828
y.create.l HWIO_BLSP1_BLSP_BAM_BAM_P_EVNT_DEST_ADDR0_ADDR A:0x789782c
y.create.l HWIO_BLSP1_BLSP_BAM_BAM_P_EVNT_DEST_ADDR1_ADDR A:0x789882c
y.create.l HWIO_BLSP1_BLSP_BAM_BAM_P_EVNT_DEST_ADDR2_ADDR A:0x789982c
y.create.l HWIO_BLSP1_BLSP_BAM_BAM_P_EVNT_DEST_ADDR3_ADDR A:0x789a82c
y.create.l HWIO_BLSP1_BLSP_BAM_BAM_P_EVNT_DEST_ADDR4_ADDR A:0x789b82c
y.create.l HWIO_BLSP1_BLSP_BAM_BAM_P_EVNT_DEST_ADDR5_ADDR A:0x789c82c
y.create.l HWIO_BLSP1_BLSP_BAM_BAM_P_EVNT_DEST_ADDR6_ADDR A:0x789d82c
y.create.l HWIO_BLSP1_BLSP_BAM_BAM_P_EVNT_DEST_ADDR7_ADDR A:0x789e82c
y.create.l HWIO_BLSP1_BLSP_BAM_BAM_P_EVNT_DEST_ADDR8_ADDR A:0x789f82c
y.create.l HWIO_BLSP1_BLSP_BAM_BAM_P_EVNT_DEST_ADDR9_ADDR A:0x78a082c
y.create.l HWIO_BLSP1_BLSP_BAM_BAM_P_DF_CNTXT_0_ADDR A:0x7897830
y.create.l HWIO_BLSP1_BLSP_BAM_BAM_P_DF_CNTXT_1_ADDR A:0x7898830
y.create.l HWIO_BLSP1_BLSP_BAM_BAM_P_DF_CNTXT_2_ADDR A:0x7899830
y.create.l HWIO_BLSP1_BLSP_BAM_BAM_P_DF_CNTXT_3_ADDR A:0x789a830
y.create.l HWIO_BLSP1_BLSP_BAM_BAM_P_DF_CNTXT_4_ADDR A:0x789b830
y.create.l HWIO_BLSP1_BLSP_BAM_BAM_P_DF_CNTXT_5_ADDR A:0x789c830
y.create.l HWIO_BLSP1_BLSP_BAM_BAM_P_DF_CNTXT_6_ADDR A:0x789d830
y.create.l HWIO_BLSP1_BLSP_BAM_BAM_P_DF_CNTXT_7_ADDR A:0x789e830
y.create.l HWIO_BLSP1_BLSP_BAM_BAM_P_DF_CNTXT_8_ADDR A:0x789f830
y.create.l HWIO_BLSP1_BLSP_BAM_BAM_P_DF_CNTXT_9_ADDR A:0x78a0830
y.create.l HWIO_BLSP1_BLSP_BAM_BAM_P_RETR_CNTXT_0_ADDR A:0x7897834
y.create.l HWIO_BLSP1_BLSP_BAM_BAM_P_RETR_CNTXT_1_ADDR A:0x7898834
y.create.l HWIO_BLSP1_BLSP_BAM_BAM_P_RETR_CNTXT_2_ADDR A:0x7899834
y.create.l HWIO_BLSP1_BLSP_BAM_BAM_P_RETR_CNTXT_3_ADDR A:0x789a834
y.create.l HWIO_BLSP1_BLSP_BAM_BAM_P_RETR_CNTXT_4_ADDR A:0x789b834
y.create.l HWIO_BLSP1_BLSP_BAM_BAM_P_RETR_CNTXT_5_ADDR A:0x789c834
y.create.l HWIO_BLSP1_BLSP_BAM_BAM_P_RETR_CNTXT_6_ADDR A:0x789d834
y.create.l HWIO_BLSP1_BLSP_BAM_BAM_P_RETR_CNTXT_7_ADDR A:0x789e834
y.create.l HWIO_BLSP1_BLSP_BAM_BAM_P_RETR_CNTXT_8_ADDR A:0x789f834
y.create.l HWIO_BLSP1_BLSP_BAM_BAM_P_RETR_CNTXT_9_ADDR A:0x78a0834
y.create.l HWIO_BLSP1_BLSP_BAM_BAM_P_SI_CNTXT_0_ADDR A:0x7897838
y.create.l HWIO_BLSP1_BLSP_BAM_BAM_P_SI_CNTXT_1_ADDR A:0x7898838
y.create.l HWIO_BLSP1_BLSP_BAM_BAM_P_SI_CNTXT_2_ADDR A:0x7899838
y.create.l HWIO_BLSP1_BLSP_BAM_BAM_P_SI_CNTXT_3_ADDR A:0x789a838
y.create.l HWIO_BLSP1_BLSP_BAM_BAM_P_SI_CNTXT_4_ADDR A:0x789b838
y.create.l HWIO_BLSP1_BLSP_BAM_BAM_P_SI_CNTXT_5_ADDR A:0x789c838
y.create.l HWIO_BLSP1_BLSP_BAM_BAM_P_SI_CNTXT_6_ADDR A:0x789d838
y.create.l HWIO_BLSP1_BLSP_BAM_BAM_P_SI_CNTXT_7_ADDR A:0x789e838
y.create.l HWIO_BLSP1_BLSP_BAM_BAM_P_SI_CNTXT_8_ADDR A:0x789f838
y.create.l HWIO_BLSP1_BLSP_BAM_BAM_P_SI_CNTXT_9_ADDR A:0x78a0838
y.create.l HWIO_BLSP1_BLSP_BAM_BAM_P_PSM_CNTXT_3_LSB0_ADDR A:0x7897900
y.create.l HWIO_BLSP1_BLSP_BAM_BAM_P_PSM_CNTXT_3_LSB1_ADDR A:0x7898900
y.create.l HWIO_BLSP1_BLSP_BAM_BAM_P_PSM_CNTXT_3_LSB2_ADDR A:0x7899900
y.create.l HWIO_BLSP1_BLSP_BAM_BAM_P_PSM_CNTXT_3_LSB3_ADDR A:0x789a900
y.create.l HWIO_BLSP1_BLSP_BAM_BAM_P_PSM_CNTXT_3_LSB4_ADDR A:0x789b900
y.create.l HWIO_BLSP1_BLSP_BAM_BAM_P_PSM_CNTXT_3_LSB5_ADDR A:0x789c900
y.create.l HWIO_BLSP1_BLSP_BAM_BAM_P_PSM_CNTXT_3_LSB6_ADDR A:0x789d900
y.create.l HWIO_BLSP1_BLSP_BAM_BAM_P_PSM_CNTXT_3_LSB7_ADDR A:0x789e900
y.create.l HWIO_BLSP1_BLSP_BAM_BAM_P_PSM_CNTXT_3_LSB8_ADDR A:0x789f900
y.create.l HWIO_BLSP1_BLSP_BAM_BAM_P_PSM_CNTXT_3_LSB9_ADDR A:0x78a0900
y.create.l HWIO_BLSP1_BLSP_BAM_BAM_P_PSM_CNTXT_3_MSB0_ADDR A:0x7897904
y.create.l HWIO_BLSP1_BLSP_BAM_BAM_P_PSM_CNTXT_3_MSB1_ADDR A:0x7898904
y.create.l HWIO_BLSP1_BLSP_BAM_BAM_P_PSM_CNTXT_3_MSB2_ADDR A:0x7899904
y.create.l HWIO_BLSP1_BLSP_BAM_BAM_P_PSM_CNTXT_3_MSB3_ADDR A:0x789a904
y.create.l HWIO_BLSP1_BLSP_BAM_BAM_P_PSM_CNTXT_3_MSB4_ADDR A:0x789b904
y.create.l HWIO_BLSP1_BLSP_BAM_BAM_P_PSM_CNTXT_3_MSB5_ADDR A:0x789c904
y.create.l HWIO_BLSP1_BLSP_BAM_BAM_P_PSM_CNTXT_3_MSB6_ADDR A:0x789d904
y.create.l HWIO_BLSP1_BLSP_BAM_BAM_P_PSM_CNTXT_3_MSB7_ADDR A:0x789e904
y.create.l HWIO_BLSP1_BLSP_BAM_BAM_P_PSM_CNTXT_3_MSB8_ADDR A:0x789f904
y.create.l HWIO_BLSP1_BLSP_BAM_BAM_P_PSM_CNTXT_3_MSB9_ADDR A:0x78a0904
y.create.l HWIO_BLSP1_BLSP_BAM_BAM_P_DESC_FIFO_ADDR_LSB0_ADDR A:0x7897910
y.create.l HWIO_BLSP1_BLSP_BAM_BAM_P_DESC_FIFO_ADDR_LSB1_ADDR A:0x7898910
y.create.l HWIO_BLSP1_BLSP_BAM_BAM_P_DESC_FIFO_ADDR_LSB2_ADDR A:0x7899910
y.create.l HWIO_BLSP1_BLSP_BAM_BAM_P_DESC_FIFO_ADDR_LSB3_ADDR A:0x789a910
y.create.l HWIO_BLSP1_BLSP_BAM_BAM_P_DESC_FIFO_ADDR_LSB4_ADDR A:0x789b910
y.create.l HWIO_BLSP1_BLSP_BAM_BAM_P_DESC_FIFO_ADDR_LSB5_ADDR A:0x789c910
y.create.l HWIO_BLSP1_BLSP_BAM_BAM_P_DESC_FIFO_ADDR_LSB6_ADDR A:0x789d910
y.create.l HWIO_BLSP1_BLSP_BAM_BAM_P_DESC_FIFO_ADDR_LSB7_ADDR A:0x789e910
y.create.l HWIO_BLSP1_BLSP_BAM_BAM_P_DESC_FIFO_ADDR_LSB8_ADDR A:0x789f910
y.create.l HWIO_BLSP1_BLSP_BAM_BAM_P_DESC_FIFO_ADDR_LSB9_ADDR A:0x78a0910
y.create.l HWIO_BLSP1_BLSP_BAM_BAM_P_DESC_FIFO_ADDR_MSB0_ADDR A:0x7897914
y.create.l HWIO_BLSP1_BLSP_BAM_BAM_P_DESC_FIFO_ADDR_MSB1_ADDR A:0x7898914
y.create.l HWIO_BLSP1_BLSP_BAM_BAM_P_DESC_FIFO_ADDR_MSB2_ADDR A:0x7899914
y.create.l HWIO_BLSP1_BLSP_BAM_BAM_P_DESC_FIFO_ADDR_MSB3_ADDR A:0x789a914
y.create.l HWIO_BLSP1_BLSP_BAM_BAM_P_DESC_FIFO_ADDR_MSB4_ADDR A:0x789b914
y.create.l HWIO_BLSP1_BLSP_BAM_BAM_P_DESC_FIFO_ADDR_MSB5_ADDR A:0x789c914
y.create.l HWIO_BLSP1_BLSP_BAM_BAM_P_DESC_FIFO_ADDR_MSB6_ADDR A:0x789d914
y.create.l HWIO_BLSP1_BLSP_BAM_BAM_P_DESC_FIFO_ADDR_MSB7_ADDR A:0x789e914
y.create.l HWIO_BLSP1_BLSP_BAM_BAM_P_DESC_FIFO_ADDR_MSB8_ADDR A:0x789f914
y.create.l HWIO_BLSP1_BLSP_BAM_BAM_P_DESC_FIFO_ADDR_MSB9_ADDR A:0x78a0914
y.create.l HWIO_BLSP1_BLSP_BAM_BAM_P_DATA_FIFO_ADDR_LSB0_ADDR A:0x7897920
y.create.l HWIO_BLSP1_BLSP_BAM_BAM_P_DATA_FIFO_ADDR_LSB1_ADDR A:0x7898920
y.create.l HWIO_BLSP1_BLSP_BAM_BAM_P_DATA_FIFO_ADDR_LSB2_ADDR A:0x7899920
y.create.l HWIO_BLSP1_BLSP_BAM_BAM_P_DATA_FIFO_ADDR_LSB3_ADDR A:0x789a920
y.create.l HWIO_BLSP1_BLSP_BAM_BAM_P_DATA_FIFO_ADDR_LSB4_ADDR A:0x789b920
y.create.l HWIO_BLSP1_BLSP_BAM_BAM_P_DATA_FIFO_ADDR_LSB5_ADDR A:0x789c920
y.create.l HWIO_BLSP1_BLSP_BAM_BAM_P_DATA_FIFO_ADDR_LSB6_ADDR A:0x789d920
y.create.l HWIO_BLSP1_BLSP_BAM_BAM_P_DATA_FIFO_ADDR_LSB7_ADDR A:0x789e920
y.create.l HWIO_BLSP1_BLSP_BAM_BAM_P_DATA_FIFO_ADDR_LSB8_ADDR A:0x789f920
y.create.l HWIO_BLSP1_BLSP_BAM_BAM_P_DATA_FIFO_ADDR_LSB9_ADDR A:0x78a0920
y.create.l HWIO_BLSP1_BLSP_BAM_BAM_P_DATA_FIFO_ADDR_MSB0_ADDR A:0x7897924
y.create.l HWIO_BLSP1_BLSP_BAM_BAM_P_DATA_FIFO_ADDR_MSB1_ADDR A:0x7898924
y.create.l HWIO_BLSP1_BLSP_BAM_BAM_P_DATA_FIFO_ADDR_MSB2_ADDR A:0x7899924
y.create.l HWIO_BLSP1_BLSP_BAM_BAM_P_DATA_FIFO_ADDR_MSB3_ADDR A:0x789a924
y.create.l HWIO_BLSP1_BLSP_BAM_BAM_P_DATA_FIFO_ADDR_MSB4_ADDR A:0x789b924
y.create.l HWIO_BLSP1_BLSP_BAM_BAM_P_DATA_FIFO_ADDR_MSB5_ADDR A:0x789c924
y.create.l HWIO_BLSP1_BLSP_BAM_BAM_P_DATA_FIFO_ADDR_MSB6_ADDR A:0x789d924
y.create.l HWIO_BLSP1_BLSP_BAM_BAM_P_DATA_FIFO_ADDR_MSB7_ADDR A:0x789e924
y.create.l HWIO_BLSP1_BLSP_BAM_BAM_P_DATA_FIFO_ADDR_MSB8_ADDR A:0x789f924
y.create.l HWIO_BLSP1_BLSP_BAM_BAM_P_DATA_FIFO_ADDR_MSB9_ADDR A:0x78a0924
y.create.l HWIO_BLSP1_BLSP_BAM_BAM_P_EVNT_DEST_ADDR_LSB0_ADDR A:0x7897930
y.create.l HWIO_BLSP1_BLSP_BAM_BAM_P_EVNT_DEST_ADDR_LSB1_ADDR A:0x7898930
y.create.l HWIO_BLSP1_BLSP_BAM_BAM_P_EVNT_DEST_ADDR_LSB2_ADDR A:0x7899930
y.create.l HWIO_BLSP1_BLSP_BAM_BAM_P_EVNT_DEST_ADDR_LSB3_ADDR A:0x789a930
y.create.l HWIO_BLSP1_BLSP_BAM_BAM_P_EVNT_DEST_ADDR_LSB4_ADDR A:0x789b930
y.create.l HWIO_BLSP1_BLSP_BAM_BAM_P_EVNT_DEST_ADDR_LSB5_ADDR A:0x789c930
y.create.l HWIO_BLSP1_BLSP_BAM_BAM_P_EVNT_DEST_ADDR_LSB6_ADDR A:0x789d930
y.create.l HWIO_BLSP1_BLSP_BAM_BAM_P_EVNT_DEST_ADDR_LSB7_ADDR A:0x789e930
y.create.l HWIO_BLSP1_BLSP_BAM_BAM_P_EVNT_DEST_ADDR_LSB8_ADDR A:0x789f930
y.create.l HWIO_BLSP1_BLSP_BAM_BAM_P_EVNT_DEST_ADDR_LSB9_ADDR A:0x78a0930
y.create.l HWIO_BLSP1_BLSP_BAM_BAM_P_EVNT_DEST_ADDR_MSB0_ADDR A:0x7897934
y.create.l HWIO_BLSP1_BLSP_BAM_BAM_P_EVNT_DEST_ADDR_MSB1_ADDR A:0x7898934
y.create.l HWIO_BLSP1_BLSP_BAM_BAM_P_EVNT_DEST_ADDR_MSB2_ADDR A:0x7899934
y.create.l HWIO_BLSP1_BLSP_BAM_BAM_P_EVNT_DEST_ADDR_MSB3_ADDR A:0x789a934
y.create.l HWIO_BLSP1_BLSP_BAM_BAM_P_EVNT_DEST_ADDR_MSB4_ADDR A:0x789b934
y.create.l HWIO_BLSP1_BLSP_BAM_BAM_P_EVNT_DEST_ADDR_MSB5_ADDR A:0x789c934
y.create.l HWIO_BLSP1_BLSP_BAM_BAM_P_EVNT_DEST_ADDR_MSB6_ADDR A:0x789d934
y.create.l HWIO_BLSP1_BLSP_BAM_BAM_P_EVNT_DEST_ADDR_MSB7_ADDR A:0x789e934
y.create.l HWIO_BLSP1_BLSP_BAM_BAM_P_EVNT_DEST_ADDR_MSB8_ADDR A:0x789f934
y.create.l HWIO_BLSP1_BLSP_BAM_BAM_P_EVNT_DEST_ADDR_MSB9_ADDR A:0x78a0934
y.create.l HWIO_BLSP1_BLSP_BAM_XPU_SCR_ADDR A:0x7882000
y.create.l HWIO_BLSP1_BLSP_BAM_XPU_SWDR_ADDR A:0x7882004
y.create.l HWIO_BLSP1_BLSP_BAM_XPU_SEAR0_ADDR A:0x7882040
y.create.l HWIO_BLSP1_BLSP_BAM_XPU_SESR_ADDR A:0x7882048
y.create.l HWIO_BLSP1_BLSP_BAM_XPU_SESRRESTORE_ADDR A:0x788204c
y.create.l HWIO_BLSP1_BLSP_BAM_XPU_SESYNR0_ADDR A:0x7882050
y.create.l HWIO_BLSP1_BLSP_BAM_XPU_SESYNR1_ADDR A:0x7882054
y.create.l HWIO_BLSP1_BLSP_BAM_XPU_SESYNR2_ADDR A:0x7882058
y.create.l HWIO_BLSP1_BLSP_BAM_XPU_MCR_ADDR A:0x7882100
y.create.l HWIO_BLSP1_BLSP_BAM_XPU_MEAR0_ADDR A:0x7882140
y.create.l HWIO_BLSP1_BLSP_BAM_XPU_MESR_ADDR A:0x7882148
y.create.l HWIO_BLSP1_BLSP_BAM_XPU_MESRRESTORE_ADDR A:0x788214c
y.create.l HWIO_BLSP1_BLSP_BAM_XPU_MESYNR0_ADDR A:0x7882150
y.create.l HWIO_BLSP1_BLSP_BAM_XPU_MESYNR1_ADDR A:0x7882154
y.create.l HWIO_BLSP1_BLSP_BAM_XPU_MESYNR2_ADDR A:0x7882158
y.create.l HWIO_BLSP1_BLSP_BAM_XPU_CR_ADDR A:0x7882080
y.create.l HWIO_BLSP1_BLSP_BAM_XPU_RPU_ACR0_ADDR A:0x78820a0
y.create.l HWIO_BLSP1_BLSP_BAM_XPU_EAR0_ADDR A:0x78820c0
y.create.l HWIO_BLSP1_BLSP_BAM_XPU_ESR_ADDR A:0x78820c8
y.create.l HWIO_BLSP1_BLSP_BAM_XPU_ESRRESTORE_ADDR A:0x78820cc
y.create.l HWIO_BLSP1_BLSP_BAM_XPU_ESYNR0_ADDR A:0x78820d0
y.create.l HWIO_BLSP1_BLSP_BAM_XPU_ESYNR1_ADDR A:0x78820d4
y.create.l HWIO_BLSP1_BLSP_BAM_XPU_ESYNR2_ADDR A:0x78820d8
y.create.l HWIO_BLSP1_BLSP_BAM_XPU_IDR0_ADDR A:0x7882074
y.create.l HWIO_BLSP1_BLSP_BAM_XPU_IDR1_ADDR A:0x7882078
y.create.l HWIO_BLSP1_BLSP_BAM_XPU_REV_ADDR A:0x788207c
y.create.l HWIO_BLSP1_BLSP_BAM_XPU_RG0_RACR0_ADDR A:0x7882200
y.create.l HWIO_BLSP1_BLSP_BAM_XPU_RG1_RACR0_ADDR A:0x7882280
y.create.l HWIO_BLSP1_BLSP_BAM_XPU_RG2_RACR0_ADDR A:0x7882300
y.create.l HWIO_BLSP1_BLSP_BAM_XPU_RG3_RACR0_ADDR A:0x7882380
y.create.l HWIO_BLSP1_BLSP_BAM_XPU_RG4_RACR0_ADDR A:0x7882400
y.create.l HWIO_BLSP1_BLSP_BAM_XPU_RG5_RACR0_ADDR A:0x7882480
y.create.l HWIO_BLSP1_BLSP_BAM_XPU_RG6_RACR0_ADDR A:0x7882500
y.create.l HWIO_BLSP1_BLSP_BAM_XPU_RG7_RACR0_ADDR A:0x7882580
y.create.l HWIO_BLSP1_BLSP_BAM_XPU_RG8_RACR0_ADDR A:0x7882600
y.create.l HWIO_BLSP1_BLSP_BAM_XPU_RG9_RACR0_ADDR A:0x7882680
y.create.l HWIO_BLSP1_BLSP_BAM_XPU_RG0_SCR_ADDR A:0x7882250
y.create.l HWIO_BLSP1_BLSP_BAM_XPU_RG1_SCR_ADDR A:0x78822d0
y.create.l HWIO_BLSP1_BLSP_BAM_XPU_RG2_SCR_ADDR A:0x7882350
y.create.l HWIO_BLSP1_BLSP_BAM_XPU_RG3_SCR_ADDR A:0x78823d0
y.create.l HWIO_BLSP1_BLSP_BAM_XPU_RG4_SCR_ADDR A:0x7882450
y.create.l HWIO_BLSP1_BLSP_BAM_XPU_RG5_SCR_ADDR A:0x78824d0
y.create.l HWIO_BLSP1_BLSP_BAM_XPU_RG6_SCR_ADDR A:0x7882550
y.create.l HWIO_BLSP1_BLSP_BAM_XPU_RG7_SCR_ADDR A:0x78825d0
y.create.l HWIO_BLSP1_BLSP_BAM_XPU_RG8_SCR_ADDR A:0x7882650
y.create.l HWIO_BLSP1_BLSP_BAM_XPU_RG9_SCR_ADDR A:0x78826d0
y.create.l HWIO_BLSP1_BLSP_BAM_XPU_RG0_MCR_ADDR A:0x7882254
y.create.l HWIO_BLSP1_BLSP_BAM_XPU_RG1_MCR_ADDR A:0x78822d4
y.create.l HWIO_BLSP1_BLSP_BAM_XPU_RG2_MCR_ADDR A:0x7882354
y.create.l HWIO_BLSP1_BLSP_BAM_XPU_RG3_MCR_ADDR A:0x78823d4
y.create.l HWIO_BLSP1_BLSP_BAM_XPU_RG4_MCR_ADDR A:0x7882454
y.create.l HWIO_BLSP1_BLSP_BAM_XPU_RG5_MCR_ADDR A:0x78824d4
y.create.l HWIO_BLSP1_BLSP_BAM_XPU_RG6_MCR_ADDR A:0x7882554
y.create.l HWIO_BLSP1_BLSP_BAM_XPU_RG7_MCR_ADDR A:0x78825d4
y.create.l HWIO_BLSP1_BLSP_BAM_XPU_RG8_MCR_ADDR A:0x7882654
y.create.l HWIO_BLSP1_BLSP_BAM_XPU_RG9_MCR_ADDR A:0x78826d4
y.create.l HWIO_BLSP1_BLSP_BAM_VMIDMT_SCR0_ADDR A:0x7880000
y.create.l HWIO_BLSP1_BLSP_BAM_VMIDMT_SCR1_ADDR A:0x7880004
y.create.l HWIO_BLSP1_BLSP_BAM_VMIDMT_SCR2_ADDR A:0x7880008
y.create.l HWIO_BLSP1_BLSP_BAM_VMIDMT_SACR_ADDR A:0x7880010
y.create.l HWIO_BLSP1_BLSP_BAM_VMIDMT_SIDR0_ADDR A:0x7880020
y.create.l HWIO_BLSP1_BLSP_BAM_VMIDMT_SIDR1_ADDR A:0x7880024
y.create.l HWIO_BLSP1_BLSP_BAM_VMIDMT_SIDR2_ADDR A:0x7880028
y.create.l HWIO_BLSP1_BLSP_BAM_VMIDMT_SIDR4_ADDR A:0x7880030
y.create.l HWIO_BLSP1_BLSP_BAM_VMIDMT_SIDR5_ADDR A:0x7880034
y.create.l HWIO_BLSP1_BLSP_BAM_VMIDMT_SIDR7_ADDR A:0x788003c
y.create.l HWIO_BLSP1_BLSP_BAM_VMIDMT_SGFAR0_ADDR A:0x7880040
y.create.l HWIO_BLSP1_BLSP_BAM_VMIDMT_SGFSR_ADDR A:0x7880048
y.create.l HWIO_BLSP1_BLSP_BAM_VMIDMT_SGFSRRESTORE_ADDR A:0x788004c
y.create.l HWIO_BLSP1_BLSP_BAM_VMIDMT_SGFSYNDR0_ADDR A:0x7880050
y.create.l HWIO_BLSP1_BLSP_BAM_VMIDMT_SGFSYNDR1_ADDR A:0x7880054
y.create.l HWIO_BLSP1_BLSP_BAM_VMIDMT_SGFSYNDR2_ADDR A:0x7880058
y.create.l HWIO_BLSP1_BLSP_BAM_VMIDMT_VMIDMTSCR0_ADDR A:0x7880090
y.create.l HWIO_BLSP1_BLSP_BAM_VMIDMT_CR0_ADDR A:0x7880000
y.create.l HWIO_BLSP1_BLSP_BAM_VMIDMT_CR2_ADDR A:0x7880008
y.create.l HWIO_BLSP1_BLSP_BAM_VMIDMT_ACR_ADDR A:0x7880010
y.create.l HWIO_BLSP1_BLSP_BAM_VMIDMT_IDR0_ADDR A:0x7880020
y.create.l HWIO_BLSP1_BLSP_BAM_VMIDMT_IDR1_ADDR A:0x7880024
y.create.l HWIO_BLSP1_BLSP_BAM_VMIDMT_IDR2_ADDR A:0x7880028
y.create.l HWIO_BLSP1_BLSP_BAM_VMIDMT_IDR4_ADDR A:0x7880030
y.create.l HWIO_BLSP1_BLSP_BAM_VMIDMT_IDR5_ADDR A:0x7880034
y.create.l HWIO_BLSP1_BLSP_BAM_VMIDMT_IDR7_ADDR A:0x788003c
y.create.l HWIO_BLSP1_BLSP_BAM_VMIDMT_GFAR0_ADDR A:0x7880040
y.create.l HWIO_BLSP1_BLSP_BAM_VMIDMT_GFSR_ADDR A:0x7880048
y.create.l HWIO_BLSP1_BLSP_BAM_VMIDMT_GFSRRESTORE_ADDR A:0x788004c
y.create.l HWIO_BLSP1_BLSP_BAM_VMIDMT_GFSYNDR0_ADDR A:0x7880050
y.create.l HWIO_BLSP1_BLSP_BAM_VMIDMT_GFSYNDR1_ADDR A:0x7880054
y.create.l HWIO_BLSP1_BLSP_BAM_VMIDMT_GFSYNDR2_ADDR A:0x7880058
y.create.l HWIO_BLSP1_BLSP_BAM_VMIDMT_VMIDMTCR0_ADDR A:0x7880090
y.create.l HWIO_BLSP1_BLSP_BAM_VMIDMT_VMIDMTACR_ADDR A:0x788009c
y.create.l HWIO_BLSP1_BLSP_BAM_VMIDMT_NSCR0_ADDR A:0x7880400
y.create.l HWIO_BLSP1_BLSP_BAM_VMIDMT_NSCR2_ADDR A:0x7880408
y.create.l HWIO_BLSP1_BLSP_BAM_VMIDMT_NSACR_ADDR A:0x7880410
y.create.l HWIO_BLSP1_BLSP_BAM_VMIDMT_NSGFAR0_ADDR A:0x7880440
y.create.l HWIO_BLSP1_BLSP_BAM_VMIDMT_NSGFSR_ADDR A:0x7880448
y.create.l HWIO_BLSP1_BLSP_BAM_VMIDMT_NSGFSRRESTORE_ADDR A:0x788044c
y.create.l HWIO_BLSP1_BLSP_BAM_VMIDMT_NSGFSYNDR0_ADDR A:0x7880450
y.create.l HWIO_BLSP1_BLSP_BAM_VMIDMT_NSGFSYNDR1_ADDR A:0x7880454
y.create.l HWIO_BLSP1_BLSP_BAM_VMIDMT_NSGFSYNDR2_ADDR A:0x7880458
y.create.l HWIO_BLSP1_BLSP_BAM_VMIDMT_NSVMIDMTCR0_ADDR A:0x7880490
y.create.l HWIO_BLSP1_BLSP_BAM_VMIDMT_SSDR0_ADDR A:0x7880080
y.create.l HWIO_BLSP1_BLSP_BAM_VMIDMT_MSDR0_ADDR A:0x7880480
y.create.l HWIO_BLSP1_BLSP_BAM_VMIDMT_MCR_ADDR A:0x7880494
y.create.l HWIO_BLSP1_BLSP_BAM_VMIDMT_S2VR0_ADDR A:0x7880c00
y.create.l HWIO_BLSP1_BLSP_BAM_VMIDMT_S2VR1_ADDR A:0x7880c04
y.create.l HWIO_BLSP1_BLSP_BAM_VMIDMT_S2VR2_ADDR A:0x7880c08
y.create.l HWIO_BLSP1_BLSP_BAM_VMIDMT_S2VR3_ADDR A:0x7880c0c
y.create.l HWIO_BLSP1_BLSP_BAM_VMIDMT_S2VR4_ADDR A:0x7880c10
y.create.l HWIO_BLSP1_BLSP_BAM_VMIDMT_S2VR5_ADDR A:0x7880c14
y.create.l HWIO_BLSP1_BLSP_BAM_VMIDMT_S2VR6_ADDR A:0x7880c18
y.create.l HWIO_BLSP1_BLSP_BAM_VMIDMT_S2VR7_ADDR A:0x7880c1c
y.create.l HWIO_BLSP1_BLSP_BAM_VMIDMT_S2VR8_ADDR A:0x7880c20
y.create.l HWIO_BLSP1_BLSP_BAM_VMIDMT_S2VR9_ADDR A:0x7880c24
y.create.l HWIO_BLSP1_BLSP_BAM_VMIDMT_AS2VR0_ADDR A:0x7880e00
y.create.l HWIO_BLSP1_BLSP_BAM_VMIDMT_AS2VR1_ADDR A:0x7880e04
y.create.l HWIO_BLSP1_BLSP_BAM_VMIDMT_AS2VR2_ADDR A:0x7880e08
y.create.l HWIO_BLSP1_BLSP_BAM_VMIDMT_AS2VR3_ADDR A:0x7880e0c
y.create.l HWIO_BLSP1_BLSP_BAM_VMIDMT_AS2VR4_ADDR A:0x7880e10
y.create.l HWIO_BLSP1_BLSP_BAM_VMIDMT_AS2VR5_ADDR A:0x7880e14
y.create.l HWIO_BLSP1_BLSP_BAM_VMIDMT_AS2VR6_ADDR A:0x7880e18
y.create.l HWIO_BLSP1_BLSP_BAM_VMIDMT_AS2VR7_ADDR A:0x7880e1c
y.create.l HWIO_BLSP1_BLSP_BAM_VMIDMT_AS2VR8_ADDR A:0x7880e20
y.create.l HWIO_BLSP1_BLSP_BAM_VMIDMT_AS2VR9_ADDR A:0x7880e24
y.create.l HWIO_BLSP1_BLSP_BAM_VMIDMT_SMR0_ADDR A:0x7880800
y.create.l HWIO_BLSP1_BLSP_BAM_VMIDMT_SMR1_ADDR A:0x7880804
y.create.l HWIO_BLSP1_BLSP_BAM_VMIDMT_SMR2_ADDR A:0x7880808
y.create.l HWIO_BLSP1_BLSP_BAM_VMIDMT_SMR3_ADDR A:0x788080c
y.create.l HWIO_BLSP1_BLSP_BAM_VMIDMT_SMR4_ADDR A:0x7880810
y.create.l HWIO_BLSP1_BLSP_BAM_VMIDMT_SMR5_ADDR A:0x7880814
y.create.l HWIO_BLSP1_BLSP_BAM_VMIDMT_SMR6_ADDR A:0x7880818
y.create.l HWIO_BLSP1_BLSP_BAM_VMIDMT_SMR7_ADDR A:0x788081c
y.create.l HWIO_BLSP1_BLSP_BAM_VMIDMT_SMR8_ADDR A:0x7880820
y.create.l HWIO_BLSP1_BLSP_BAM_VMIDMT_SMR9_ADDR A:0x7880824
y.create.l HWIO_BLSP1_BLSP_UART0_UART_DM_MR1_ADDR A:0x78af000
y.create.l HWIO_BLSP1_BLSP_UART0_UART_DM_MR2_ADDR A:0x78af004
y.create.l HWIO_BLSP1_BLSP_UART0_UART_DM_CSR_SR_DEPRECATED_ADDR A:0x78af008
y.create.l HWIO_BLSP1_BLSP_UART0_UART_DM_CR_MISR_DEPRECATED_ADDR A:0x78af010
y.create.l HWIO_BLSP1_BLSP_UART0_UART_DM_IMR_ISR_DEPRECATED_ADDR A:0x78af014
y.create.l HWIO_BLSP1_BLSP_UART0_UART_DM_IPR_ADDR A:0x78af018
y.create.l HWIO_BLSP1_BLSP_UART0_UART_DM_TFWR_ADDR A:0x78af01c
y.create.l HWIO_BLSP1_BLSP_UART0_UART_DM_RFWR_ADDR A:0x78af020
y.create.l HWIO_BLSP1_BLSP_UART0_UART_DM_HCR_ADDR A:0x78af024
y.create.l HWIO_BLSP1_BLSP_UART0_UART_DM_DMRX_ADDR A:0x78af034
y.create.l HWIO_BLSP1_BLSP_UART0_UART_DM_IRDA_RX_TOTAL_SNAP_DEPRECATED_ADDR A:0x78af038
y.create.l HWIO_BLSP1_BLSP_UART0_UART_DM_DMEN_ADDR A:0x78af03c
y.create.l HWIO_BLSP1_BLSP_UART0_UART_DM_NO_CHARS_FOR_TX_ADDR A:0x78af040
y.create.l HWIO_BLSP1_BLSP_UART0_UART_DM_BADR_ADDR A:0x78af044
y.create.l HWIO_BLSP1_BLSP_UART0_UART_DM_TESTSL_ADDR A:0x78af048
y.create.l HWIO_BLSP1_BLSP_UART0_UART_DM_TXFS_ADDR A:0x78af04c
y.create.l HWIO_BLSP1_BLSP_UART0_UART_DM_RXFS_ADDR A:0x78af050
y.create.l HWIO_BLSP1_BLSP_UART0_UART_DM_MISR_MODE_ADDR A:0x78af060
y.create.l HWIO_BLSP1_BLSP_UART0_UART_DM_MISR_RESET_ADDR A:0x78af064
y.create.l HWIO_BLSP1_BLSP_UART0_UART_DM_MISR_EXPORT_ADDR A:0x78af068
y.create.l HWIO_BLSP1_BLSP_UART0_UART_DM_MISR_VAL_ADDR A:0x78af06c
y.create.l HWIO_BLSP1_BLSP_UART0_UART_DM_TF_RF_DEPRECATED_ADDR A:0x78af070
y.create.l HWIO_BLSP1_BLSP_UART0_UART_DM_TF_RF_2_DEPRECATED_ADDR A:0x78af074
y.create.l HWIO_BLSP1_BLSP_UART0_UART_DM_TF_RF_3_DEPRECATED_ADDR A:0x78af078
y.create.l HWIO_BLSP1_BLSP_UART0_UART_DM_TF_RF_4_DEPRECATED_ADDR A:0x78af07c
y.create.l HWIO_BLSP1_BLSP_UART0_UART_DM_SIM_CFG_ADDR A:0x78af080
y.create.l HWIO_BLSP1_BLSP_UART0_UART_DM_TEST_WR_ADDR_ADDR A:0x78af084
y.create.l HWIO_BLSP1_BLSP_UART0_UART_DM_TEST_WR_DATA_ADDR A:0x78af088
y.create.l HWIO_BLSP1_BLSP_UART0_UART_DM_TEST_RD_ADDR_ADDR A:0x78af08c
y.create.l HWIO_BLSP1_BLSP_UART0_UART_DM_TEST_RD_DATA_ADDR A:0x78af090
y.create.l HWIO_BLSP1_BLSP_UART0_UART_DM_CSR_ADDR A:0x78af0a0
y.create.l HWIO_BLSP1_BLSP_UART0_UART_DM_SR_ADDR A:0x78af0a4
y.create.l HWIO_BLSP1_BLSP_UART0_UART_DM_CR_ADDR A:0x78af0a8
y.create.l HWIO_BLSP1_BLSP_UART0_UART_DM_MISR_ADDR A:0x78af0ac
y.create.l HWIO_BLSP1_BLSP_UART0_UART_DM_IMR_ADDR A:0x78af0b0
y.create.l HWIO_BLSP1_BLSP_UART0_UART_DM_ISR_ADDR A:0x78af0b4
y.create.l HWIO_BLSP1_BLSP_UART0_UART_DM_IRDA_ADDR A:0x78af0b8
y.create.l HWIO_BLSP1_BLSP_UART0_UART_DM_RX_TOTAL_SNAP_ADDR A:0x78af0bc
y.create.l HWIO_BLSP1_BLSP_UART0_UART_DM_WWT_TIMEOUT_ADDR A:0x78af0c0
y.create.l HWIO_BLSP1_BLSP_UART0_UART_DM_CLK_CTRL_ADDR A:0x78af0c4
y.create.l HWIO_BLSP1_BLSP_UART0_UART_DM_BCR_ADDR A:0x78af0c8
y.create.l HWIO_BLSP1_BLSP_UART0_UART_DM_RX_TRANS_CTRL_ADDR A:0x78af0cc
y.create.l HWIO_BLSP1_BLSP_UART0_UART_DM_DMRX_DBG_ADDR A:0x78af0d0
y.create.l HWIO_BLSP1_BLSP_UART0_UART_DM_FSM_STATUS_ADDR A:0x78af0d4
y.create.l HWIO_BLSP1_BLSP_UART0_UART_DM_HW_VERSION_ADDR A:0x78af0d8
y.create.l HWIO_BLSP1_BLSP_UART0_UART_DM_GENERICS_ADDR A:0x78af0dc
y.create.l HWIO_BLSP1_BLSP_UART0_UART_DM_ISR_CLR_ADDR A:0x78af0e0
y.create.l HWIO_BLSP1_BLSP_UART0_UART_DM_TF_ADDR A:0x78af100
y.create.l HWIO_BLSP1_BLSP_UART0_UART_DM_TF_2_ADDR A:0x78af104
y.create.l HWIO_BLSP1_BLSP_UART0_UART_DM_TF_3_ADDR A:0x78af108
y.create.l HWIO_BLSP1_BLSP_UART0_UART_DM_TF_4_ADDR A:0x78af10c
y.create.l HWIO_BLSP1_BLSP_UART0_UART_DM_TF_5_ADDR A:0x78af110
y.create.l HWIO_BLSP1_BLSP_UART0_UART_DM_TF_6_ADDR A:0x78af114
y.create.l HWIO_BLSP1_BLSP_UART0_UART_DM_TF_7_ADDR A:0x78af118
y.create.l HWIO_BLSP1_BLSP_UART0_UART_DM_TF_8_ADDR A:0x78af11c
y.create.l HWIO_BLSP1_BLSP_UART0_UART_DM_TF_9_ADDR A:0x78af120
y.create.l HWIO_BLSP1_BLSP_UART0_UART_DM_TF_10_ADDR A:0x78af124
y.create.l HWIO_BLSP1_BLSP_UART0_UART_DM_TF_11_ADDR A:0x78af128
y.create.l HWIO_BLSP1_BLSP_UART0_UART_DM_TF_12_ADDR A:0x78af12c
y.create.l HWIO_BLSP1_BLSP_UART0_UART_DM_TF_13_ADDR A:0x78af130
y.create.l HWIO_BLSP1_BLSP_UART0_UART_DM_TF_14_ADDR A:0x78af134
y.create.l HWIO_BLSP1_BLSP_UART0_UART_DM_TF_15_ADDR A:0x78af138
y.create.l HWIO_BLSP1_BLSP_UART0_UART_DM_TF_16_ADDR A:0x78af13c
y.create.l HWIO_BLSP1_BLSP_UART0_UART_DM_RF_ADDR A:0x78af140
y.create.l HWIO_BLSP1_BLSP_UART0_UART_DM_RF_2_ADDR A:0x78af144
y.create.l HWIO_BLSP1_BLSP_UART0_UART_DM_RF_3_ADDR A:0x78af148
y.create.l HWIO_BLSP1_BLSP_UART0_UART_DM_RF_4_ADDR A:0x78af14c
y.create.l HWIO_BLSP1_BLSP_UART0_UART_DM_RF_5_ADDR A:0x78af150
y.create.l HWIO_BLSP1_BLSP_UART0_UART_DM_RF_6_ADDR A:0x78af154
y.create.l HWIO_BLSP1_BLSP_UART0_UART_DM_RF_7_ADDR A:0x78af158
y.create.l HWIO_BLSP1_BLSP_UART0_UART_DM_RF_8_ADDR A:0x78af15c
y.create.l HWIO_BLSP1_BLSP_UART0_UART_DM_RF_9_ADDR A:0x78af160
y.create.l HWIO_BLSP1_BLSP_UART0_UART_DM_RF_10_ADDR A:0x78af164
y.create.l HWIO_BLSP1_BLSP_UART0_UART_DM_RF_11_ADDR A:0x78af168
y.create.l HWIO_BLSP1_BLSP_UART0_UART_DM_RF_12_ADDR A:0x78af16c
y.create.l HWIO_BLSP1_BLSP_UART0_UART_DM_RF_13_ADDR A:0x78af170
y.create.l HWIO_BLSP1_BLSP_UART0_UART_DM_RF_14_ADDR A:0x78af174
y.create.l HWIO_BLSP1_BLSP_UART0_UART_DM_RF_15_ADDR A:0x78af178
y.create.l HWIO_BLSP1_BLSP_UART0_UART_DM_RF_16_ADDR A:0x78af17c
y.create.l HWIO_BLSP1_BLSP_UART0_UART_DM_UIM_CFG_ADDR A:0x78af180
y.create.l HWIO_BLSP1_BLSP_UART0_UART_DM_UIM_CMD_ADDR A:0x78af184
y.create.l HWIO_BLSP1_BLSP_UART0_UART_DM_UIM_IO_STATUS_ADDR A:0x78af188
y.create.l HWIO_BLSP1_BLSP_UART0_UART_DM_UIM_IRQ_ISR_ADDR A:0x78af18c
y.create.l HWIO_BLSP1_BLSP_UART0_UART_DM_UIM_IRQ_MISR_ADDR A:0x78af190
y.create.l HWIO_BLSP1_BLSP_UART0_UART_DM_UIM_IRQ_CLR_ADDR A:0x78af194
y.create.l HWIO_BLSP1_BLSP_UART0_UART_DM_UIM_IRQ_IMR_ADDR A:0x78af198
y.create.l HWIO_BLSP1_BLSP_UART0_UART_DM_UIM_IRQ_IMR_SET_ADDR A:0x78af19c
y.create.l HWIO_BLSP1_BLSP_UART0_UART_DM_UIM_IRQ_IMR_CLR_ADDR A:0x78af1a0
y.create.l HWIO_BLSP1_BLSP_UART1_UART_DM_MR1_ADDR A:0x78b0000
y.create.l HWIO_BLSP1_BLSP_UART1_UART_DM_MR2_ADDR A:0x78b0004
y.create.l HWIO_BLSP1_BLSP_UART1_UART_DM_CSR_SR_DEPRECATED_ADDR A:0x78b0008
y.create.l HWIO_BLSP1_BLSP_UART1_UART_DM_CR_MISR_DEPRECATED_ADDR A:0x78b0010
y.create.l HWIO_BLSP1_BLSP_UART1_UART_DM_IMR_ISR_DEPRECATED_ADDR A:0x78b0014
y.create.l HWIO_BLSP1_BLSP_UART1_UART_DM_IPR_ADDR A:0x78b0018
y.create.l HWIO_BLSP1_BLSP_UART1_UART_DM_TFWR_ADDR A:0x78b001c
y.create.l HWIO_BLSP1_BLSP_UART1_UART_DM_RFWR_ADDR A:0x78b0020
y.create.l HWIO_BLSP1_BLSP_UART1_UART_DM_HCR_ADDR A:0x78b0024
y.create.l HWIO_BLSP1_BLSP_UART1_UART_DM_DMRX_ADDR A:0x78b0034
y.create.l HWIO_BLSP1_BLSP_UART1_UART_DM_IRDA_RX_TOTAL_SNAP_DEPRECATED_ADDR A:0x78b0038
y.create.l HWIO_BLSP1_BLSP_UART1_UART_DM_DMEN_ADDR A:0x78b003c
y.create.l HWIO_BLSP1_BLSP_UART1_UART_DM_NO_CHARS_FOR_TX_ADDR A:0x78b0040
y.create.l HWIO_BLSP1_BLSP_UART1_UART_DM_BADR_ADDR A:0x78b0044
y.create.l HWIO_BLSP1_BLSP_UART1_UART_DM_TESTSL_ADDR A:0x78b0048
y.create.l HWIO_BLSP1_BLSP_UART1_UART_DM_TXFS_ADDR A:0x78b004c
y.create.l HWIO_BLSP1_BLSP_UART1_UART_DM_RXFS_ADDR A:0x78b0050
y.create.l HWIO_BLSP1_BLSP_UART1_UART_DM_MISR_MODE_ADDR A:0x78b0060
y.create.l HWIO_BLSP1_BLSP_UART1_UART_DM_MISR_RESET_ADDR A:0x78b0064
y.create.l HWIO_BLSP1_BLSP_UART1_UART_DM_MISR_EXPORT_ADDR A:0x78b0068
y.create.l HWIO_BLSP1_BLSP_UART1_UART_DM_MISR_VAL_ADDR A:0x78b006c
y.create.l HWIO_BLSP1_BLSP_UART1_UART_DM_TF_RF_DEPRECATED_ADDR A:0x78b0070
y.create.l HWIO_BLSP1_BLSP_UART1_UART_DM_TF_RF_2_DEPRECATED_ADDR A:0x78b0074
y.create.l HWIO_BLSP1_BLSP_UART1_UART_DM_TF_RF_3_DEPRECATED_ADDR A:0x78b0078
y.create.l HWIO_BLSP1_BLSP_UART1_UART_DM_TF_RF_4_DEPRECATED_ADDR A:0x78b007c
y.create.l HWIO_BLSP1_BLSP_UART1_UART_DM_SIM_CFG_ADDR A:0x78b0080
y.create.l HWIO_BLSP1_BLSP_UART1_UART_DM_TEST_WR_ADDR_ADDR A:0x78b0084
y.create.l HWIO_BLSP1_BLSP_UART1_UART_DM_TEST_WR_DATA_ADDR A:0x78b0088
y.create.l HWIO_BLSP1_BLSP_UART1_UART_DM_TEST_RD_ADDR_ADDR A:0x78b008c
y.create.l HWIO_BLSP1_BLSP_UART1_UART_DM_TEST_RD_DATA_ADDR A:0x78b0090
y.create.l HWIO_BLSP1_BLSP_UART1_UART_DM_CSR_ADDR A:0x78b00a0
y.create.l HWIO_BLSP1_BLSP_UART1_UART_DM_SR_ADDR A:0x78b00a4
y.create.l HWIO_BLSP1_BLSP_UART1_UART_DM_CR_ADDR A:0x78b00a8
y.create.l HWIO_BLSP1_BLSP_UART1_UART_DM_MISR_ADDR A:0x78b00ac
y.create.l HWIO_BLSP1_BLSP_UART1_UART_DM_IMR_ADDR A:0x78b00b0
y.create.l HWIO_BLSP1_BLSP_UART1_UART_DM_ISR_ADDR A:0x78b00b4
y.create.l HWIO_BLSP1_BLSP_UART1_UART_DM_IRDA_ADDR A:0x78b00b8
y.create.l HWIO_BLSP1_BLSP_UART1_UART_DM_RX_TOTAL_SNAP_ADDR A:0x78b00bc
y.create.l HWIO_BLSP1_BLSP_UART1_UART_DM_WWT_TIMEOUT_ADDR A:0x78b00c0
y.create.l HWIO_BLSP1_BLSP_UART1_UART_DM_CLK_CTRL_ADDR A:0x78b00c4
y.create.l HWIO_BLSP1_BLSP_UART1_UART_DM_BCR_ADDR A:0x78b00c8
y.create.l HWIO_BLSP1_BLSP_UART1_UART_DM_RX_TRANS_CTRL_ADDR A:0x78b00cc
y.create.l HWIO_BLSP1_BLSP_UART1_UART_DM_DMRX_DBG_ADDR A:0x78b00d0
y.create.l HWIO_BLSP1_BLSP_UART1_UART_DM_FSM_STATUS_ADDR A:0x78b00d4
y.create.l HWIO_BLSP1_BLSP_UART1_UART_DM_HW_VERSION_ADDR A:0x78b00d8
y.create.l HWIO_BLSP1_BLSP_UART1_UART_DM_GENERICS_ADDR A:0x78b00dc
y.create.l HWIO_BLSP1_BLSP_UART1_UART_DM_ISR_CLR_ADDR A:0x78b00e0
y.create.l HWIO_BLSP1_BLSP_UART1_UART_DM_TF_ADDR A:0x78b0100
y.create.l HWIO_BLSP1_BLSP_UART1_UART_DM_TF_2_ADDR A:0x78b0104
y.create.l HWIO_BLSP1_BLSP_UART1_UART_DM_TF_3_ADDR A:0x78b0108
y.create.l HWIO_BLSP1_BLSP_UART1_UART_DM_TF_4_ADDR A:0x78b010c
y.create.l HWIO_BLSP1_BLSP_UART1_UART_DM_TF_5_ADDR A:0x78b0110
y.create.l HWIO_BLSP1_BLSP_UART1_UART_DM_TF_6_ADDR A:0x78b0114
y.create.l HWIO_BLSP1_BLSP_UART1_UART_DM_TF_7_ADDR A:0x78b0118
y.create.l HWIO_BLSP1_BLSP_UART1_UART_DM_TF_8_ADDR A:0x78b011c
y.create.l HWIO_BLSP1_BLSP_UART1_UART_DM_TF_9_ADDR A:0x78b0120
y.create.l HWIO_BLSP1_BLSP_UART1_UART_DM_TF_10_ADDR A:0x78b0124
y.create.l HWIO_BLSP1_BLSP_UART1_UART_DM_TF_11_ADDR A:0x78b0128
y.create.l HWIO_BLSP1_BLSP_UART1_UART_DM_TF_12_ADDR A:0x78b012c
y.create.l HWIO_BLSP1_BLSP_UART1_UART_DM_TF_13_ADDR A:0x78b0130
y.create.l HWIO_BLSP1_BLSP_UART1_UART_DM_TF_14_ADDR A:0x78b0134
y.create.l HWIO_BLSP1_BLSP_UART1_UART_DM_TF_15_ADDR A:0x78b0138
y.create.l HWIO_BLSP1_BLSP_UART1_UART_DM_TF_16_ADDR A:0x78b013c
y.create.l HWIO_BLSP1_BLSP_UART1_UART_DM_RF_ADDR A:0x78b0140
y.create.l HWIO_BLSP1_BLSP_UART1_UART_DM_RF_2_ADDR A:0x78b0144
y.create.l HWIO_BLSP1_BLSP_UART1_UART_DM_RF_3_ADDR A:0x78b0148
y.create.l HWIO_BLSP1_BLSP_UART1_UART_DM_RF_4_ADDR A:0x78b014c
y.create.l HWIO_BLSP1_BLSP_UART1_UART_DM_RF_5_ADDR A:0x78b0150
y.create.l HWIO_BLSP1_BLSP_UART1_UART_DM_RF_6_ADDR A:0x78b0154
y.create.l HWIO_BLSP1_BLSP_UART1_UART_DM_RF_7_ADDR A:0x78b0158
y.create.l HWIO_BLSP1_BLSP_UART1_UART_DM_RF_8_ADDR A:0x78b015c
y.create.l HWIO_BLSP1_BLSP_UART1_UART_DM_RF_9_ADDR A:0x78b0160
y.create.l HWIO_BLSP1_BLSP_UART1_UART_DM_RF_10_ADDR A:0x78b0164
y.create.l HWIO_BLSP1_BLSP_UART1_UART_DM_RF_11_ADDR A:0x78b0168
y.create.l HWIO_BLSP1_BLSP_UART1_UART_DM_RF_12_ADDR A:0x78b016c
y.create.l HWIO_BLSP1_BLSP_UART1_UART_DM_RF_13_ADDR A:0x78b0170
y.create.l HWIO_BLSP1_BLSP_UART1_UART_DM_RF_14_ADDR A:0x78b0174
y.create.l HWIO_BLSP1_BLSP_UART1_UART_DM_RF_15_ADDR A:0x78b0178
y.create.l HWIO_BLSP1_BLSP_UART1_UART_DM_RF_16_ADDR A:0x78b017c
y.create.l HWIO_BLSP1_BLSP_UART1_UART_DM_UIM_CFG_ADDR A:0x78b0180
y.create.l HWIO_BLSP1_BLSP_UART1_UART_DM_UIM_CMD_ADDR A:0x78b0184
y.create.l HWIO_BLSP1_BLSP_UART1_UART_DM_UIM_IO_STATUS_ADDR A:0x78b0188
y.create.l HWIO_BLSP1_BLSP_UART1_UART_DM_UIM_IRQ_ISR_ADDR A:0x78b018c
y.create.l HWIO_BLSP1_BLSP_UART1_UART_DM_UIM_IRQ_MISR_ADDR A:0x78b0190
y.create.l HWIO_BLSP1_BLSP_UART1_UART_DM_UIM_IRQ_CLR_ADDR A:0x78b0194
y.create.l HWIO_BLSP1_BLSP_UART1_UART_DM_UIM_IRQ_IMR_ADDR A:0x78b0198
y.create.l HWIO_BLSP1_BLSP_UART1_UART_DM_UIM_IRQ_IMR_SET_ADDR A:0x78b019c
y.create.l HWIO_BLSP1_BLSP_UART1_UART_DM_UIM_IRQ_IMR_CLR_ADDR A:0x78b01a0
y.create.l HWIO_BLSP1_BLSP_UART2_UART_DM_MR1_ADDR A:0x78b1000
y.create.l HWIO_BLSP1_BLSP_UART2_UART_DM_MR2_ADDR A:0x78b1004
y.create.l HWIO_BLSP1_BLSP_UART2_UART_DM_CSR_SR_DEPRECATED_ADDR A:0x78b1008
y.create.l HWIO_BLSP1_BLSP_UART2_UART_DM_CR_MISR_DEPRECATED_ADDR A:0x78b1010
y.create.l HWIO_BLSP1_BLSP_UART2_UART_DM_IMR_ISR_DEPRECATED_ADDR A:0x78b1014
y.create.l HWIO_BLSP1_BLSP_UART2_UART_DM_IPR_ADDR A:0x78b1018
y.create.l HWIO_BLSP1_BLSP_UART2_UART_DM_TFWR_ADDR A:0x78b101c
y.create.l HWIO_BLSP1_BLSP_UART2_UART_DM_RFWR_ADDR A:0x78b1020
y.create.l HWIO_BLSP1_BLSP_UART2_UART_DM_HCR_ADDR A:0x78b1024
y.create.l HWIO_BLSP1_BLSP_UART2_UART_DM_DMRX_ADDR A:0x78b1034
y.create.l HWIO_BLSP1_BLSP_UART2_UART_DM_IRDA_RX_TOTAL_SNAP_DEPRECATED_ADDR A:0x78b1038
y.create.l HWIO_BLSP1_BLSP_UART2_UART_DM_DMEN_ADDR A:0x78b103c
y.create.l HWIO_BLSP1_BLSP_UART2_UART_DM_NO_CHARS_FOR_TX_ADDR A:0x78b1040
y.create.l HWIO_BLSP1_BLSP_UART2_UART_DM_BADR_ADDR A:0x78b1044
y.create.l HWIO_BLSP1_BLSP_UART2_UART_DM_TESTSL_ADDR A:0x78b1048
y.create.l HWIO_BLSP1_BLSP_UART2_UART_DM_TXFS_ADDR A:0x78b104c
y.create.l HWIO_BLSP1_BLSP_UART2_UART_DM_RXFS_ADDR A:0x78b1050
y.create.l HWIO_BLSP1_BLSP_UART2_UART_DM_MISR_MODE_ADDR A:0x78b1060
y.create.l HWIO_BLSP1_BLSP_UART2_UART_DM_MISR_RESET_ADDR A:0x78b1064
y.create.l HWIO_BLSP1_BLSP_UART2_UART_DM_MISR_EXPORT_ADDR A:0x78b1068
y.create.l HWIO_BLSP1_BLSP_UART2_UART_DM_MISR_VAL_ADDR A:0x78b106c
y.create.l HWIO_BLSP1_BLSP_UART2_UART_DM_TF_RF_DEPRECATED_ADDR A:0x78b1070
y.create.l HWIO_BLSP1_BLSP_UART2_UART_DM_TF_RF_2_DEPRECATED_ADDR A:0x78b1074
y.create.l HWIO_BLSP1_BLSP_UART2_UART_DM_TF_RF_3_DEPRECATED_ADDR A:0x78b1078
y.create.l HWIO_BLSP1_BLSP_UART2_UART_DM_TF_RF_4_DEPRECATED_ADDR A:0x78b107c
y.create.l HWIO_BLSP1_BLSP_UART2_UART_DM_SIM_CFG_ADDR A:0x78b1080
y.create.l HWIO_BLSP1_BLSP_UART2_UART_DM_TEST_WR_ADDR_ADDR A:0x78b1084
y.create.l HWIO_BLSP1_BLSP_UART2_UART_DM_TEST_WR_DATA_ADDR A:0x78b1088
y.create.l HWIO_BLSP1_BLSP_UART2_UART_DM_TEST_RD_ADDR_ADDR A:0x78b108c
y.create.l HWIO_BLSP1_BLSP_UART2_UART_DM_TEST_RD_DATA_ADDR A:0x78b1090
y.create.l HWIO_BLSP1_BLSP_UART2_UART_DM_CSR_ADDR A:0x78b10a0
y.create.l HWIO_BLSP1_BLSP_UART2_UART_DM_SR_ADDR A:0x78b10a4
y.create.l HWIO_BLSP1_BLSP_UART2_UART_DM_CR_ADDR A:0x78b10a8
y.create.l HWIO_BLSP1_BLSP_UART2_UART_DM_MISR_ADDR A:0x78b10ac
y.create.l HWIO_BLSP1_BLSP_UART2_UART_DM_IMR_ADDR A:0x78b10b0
y.create.l HWIO_BLSP1_BLSP_UART2_UART_DM_ISR_ADDR A:0x78b10b4
y.create.l HWIO_BLSP1_BLSP_UART2_UART_DM_IRDA_ADDR A:0x78b10b8
y.create.l HWIO_BLSP1_BLSP_UART2_UART_DM_RX_TOTAL_SNAP_ADDR A:0x78b10bc
y.create.l HWIO_BLSP1_BLSP_UART2_UART_DM_WWT_TIMEOUT_ADDR A:0x78b10c0
y.create.l HWIO_BLSP1_BLSP_UART2_UART_DM_CLK_CTRL_ADDR A:0x78b10c4
y.create.l HWIO_BLSP1_BLSP_UART2_UART_DM_BCR_ADDR A:0x78b10c8
y.create.l HWIO_BLSP1_BLSP_UART2_UART_DM_RX_TRANS_CTRL_ADDR A:0x78b10cc
y.create.l HWIO_BLSP1_BLSP_UART2_UART_DM_DMRX_DBG_ADDR A:0x78b10d0
y.create.l HWIO_BLSP1_BLSP_UART2_UART_DM_FSM_STATUS_ADDR A:0x78b10d4
y.create.l HWIO_BLSP1_BLSP_UART2_UART_DM_HW_VERSION_ADDR A:0x78b10d8
y.create.l HWIO_BLSP1_BLSP_UART2_UART_DM_GENERICS_ADDR A:0x78b10dc
y.create.l HWIO_BLSP1_BLSP_UART2_UART_DM_ISR_CLR_ADDR A:0x78b10e0
y.create.l HWIO_BLSP1_BLSP_UART2_UART_DM_TF_ADDR A:0x78b1100
y.create.l HWIO_BLSP1_BLSP_UART2_UART_DM_TF_2_ADDR A:0x78b1104
y.create.l HWIO_BLSP1_BLSP_UART2_UART_DM_TF_3_ADDR A:0x78b1108
y.create.l HWIO_BLSP1_BLSP_UART2_UART_DM_TF_4_ADDR A:0x78b110c
y.create.l HWIO_BLSP1_BLSP_UART2_UART_DM_TF_5_ADDR A:0x78b1110
y.create.l HWIO_BLSP1_BLSP_UART2_UART_DM_TF_6_ADDR A:0x78b1114
y.create.l HWIO_BLSP1_BLSP_UART2_UART_DM_TF_7_ADDR A:0x78b1118
y.create.l HWIO_BLSP1_BLSP_UART2_UART_DM_TF_8_ADDR A:0x78b111c
y.create.l HWIO_BLSP1_BLSP_UART2_UART_DM_TF_9_ADDR A:0x78b1120
y.create.l HWIO_BLSP1_BLSP_UART2_UART_DM_TF_10_ADDR A:0x78b1124
y.create.l HWIO_BLSP1_BLSP_UART2_UART_DM_TF_11_ADDR A:0x78b1128
y.create.l HWIO_BLSP1_BLSP_UART2_UART_DM_TF_12_ADDR A:0x78b112c
y.create.l HWIO_BLSP1_BLSP_UART2_UART_DM_TF_13_ADDR A:0x78b1130
y.create.l HWIO_BLSP1_BLSP_UART2_UART_DM_TF_14_ADDR A:0x78b1134
y.create.l HWIO_BLSP1_BLSP_UART2_UART_DM_TF_15_ADDR A:0x78b1138
y.create.l HWIO_BLSP1_BLSP_UART2_UART_DM_TF_16_ADDR A:0x78b113c
y.create.l HWIO_BLSP1_BLSP_UART2_UART_DM_RF_ADDR A:0x78b1140
y.create.l HWIO_BLSP1_BLSP_UART2_UART_DM_RF_2_ADDR A:0x78b1144
y.create.l HWIO_BLSP1_BLSP_UART2_UART_DM_RF_3_ADDR A:0x78b1148
y.create.l HWIO_BLSP1_BLSP_UART2_UART_DM_RF_4_ADDR A:0x78b114c
y.create.l HWIO_BLSP1_BLSP_UART2_UART_DM_RF_5_ADDR A:0x78b1150
y.create.l HWIO_BLSP1_BLSP_UART2_UART_DM_RF_6_ADDR A:0x78b1154
y.create.l HWIO_BLSP1_BLSP_UART2_UART_DM_RF_7_ADDR A:0x78b1158
y.create.l HWIO_BLSP1_BLSP_UART2_UART_DM_RF_8_ADDR A:0x78b115c
y.create.l HWIO_BLSP1_BLSP_UART2_UART_DM_RF_9_ADDR A:0x78b1160
y.create.l HWIO_BLSP1_BLSP_UART2_UART_DM_RF_10_ADDR A:0x78b1164
y.create.l HWIO_BLSP1_BLSP_UART2_UART_DM_RF_11_ADDR A:0x78b1168
y.create.l HWIO_BLSP1_BLSP_UART2_UART_DM_RF_12_ADDR A:0x78b116c
y.create.l HWIO_BLSP1_BLSP_UART2_UART_DM_RF_13_ADDR A:0x78b1170
y.create.l HWIO_BLSP1_BLSP_UART2_UART_DM_RF_14_ADDR A:0x78b1174
y.create.l HWIO_BLSP1_BLSP_UART2_UART_DM_RF_15_ADDR A:0x78b1178
y.create.l HWIO_BLSP1_BLSP_UART2_UART_DM_RF_16_ADDR A:0x78b117c
y.create.l HWIO_BLSP1_BLSP_UART2_UART_DM_UIM_CFG_ADDR A:0x78b1180
y.create.l HWIO_BLSP1_BLSP_UART2_UART_DM_UIM_CMD_ADDR A:0x78b1184
y.create.l HWIO_BLSP1_BLSP_UART2_UART_DM_UIM_IO_STATUS_ADDR A:0x78b1188
y.create.l HWIO_BLSP1_BLSP_UART2_UART_DM_UIM_IRQ_ISR_ADDR A:0x78b118c
y.create.l HWIO_BLSP1_BLSP_UART2_UART_DM_UIM_IRQ_MISR_ADDR A:0x78b1190
y.create.l HWIO_BLSP1_BLSP_UART2_UART_DM_UIM_IRQ_CLR_ADDR A:0x78b1194
y.create.l HWIO_BLSP1_BLSP_UART2_UART_DM_UIM_IRQ_IMR_ADDR A:0x78b1198
y.create.l HWIO_BLSP1_BLSP_UART2_UART_DM_UIM_IRQ_IMR_SET_ADDR A:0x78b119c
y.create.l HWIO_BLSP1_BLSP_UART2_UART_DM_UIM_IRQ_IMR_CLR_ADDR A:0x78b11a0
y.create.l HWIO_BLSP1_BLSP_UART3_UART_DM_MR1_ADDR A:0x78b2000
y.create.l HWIO_BLSP1_BLSP_UART3_UART_DM_MR2_ADDR A:0x78b2004
y.create.l HWIO_BLSP1_BLSP_UART3_UART_DM_CSR_SR_DEPRECATED_ADDR A:0x78b2008
y.create.l HWIO_BLSP1_BLSP_UART3_UART_DM_CR_MISR_DEPRECATED_ADDR A:0x78b2010
y.create.l HWIO_BLSP1_BLSP_UART3_UART_DM_IMR_ISR_DEPRECATED_ADDR A:0x78b2014
y.create.l HWIO_BLSP1_BLSP_UART3_UART_DM_IPR_ADDR A:0x78b2018
y.create.l HWIO_BLSP1_BLSP_UART3_UART_DM_TFWR_ADDR A:0x78b201c
y.create.l HWIO_BLSP1_BLSP_UART3_UART_DM_RFWR_ADDR A:0x78b2020
y.create.l HWIO_BLSP1_BLSP_UART3_UART_DM_HCR_ADDR A:0x78b2024
y.create.l HWIO_BLSP1_BLSP_UART3_UART_DM_DMRX_ADDR A:0x78b2034
y.create.l HWIO_BLSP1_BLSP_UART3_UART_DM_IRDA_RX_TOTAL_SNAP_DEPRECATED_ADDR A:0x78b2038
y.create.l HWIO_BLSP1_BLSP_UART3_UART_DM_DMEN_ADDR A:0x78b203c
y.create.l HWIO_BLSP1_BLSP_UART3_UART_DM_NO_CHARS_FOR_TX_ADDR A:0x78b2040
y.create.l HWIO_BLSP1_BLSP_UART3_UART_DM_BADR_ADDR A:0x78b2044
y.create.l HWIO_BLSP1_BLSP_UART3_UART_DM_TESTSL_ADDR A:0x78b2048
y.create.l HWIO_BLSP1_BLSP_UART3_UART_DM_TXFS_ADDR A:0x78b204c
y.create.l HWIO_BLSP1_BLSP_UART3_UART_DM_RXFS_ADDR A:0x78b2050
y.create.l HWIO_BLSP1_BLSP_UART3_UART_DM_MISR_MODE_ADDR A:0x78b2060
y.create.l HWIO_BLSP1_BLSP_UART3_UART_DM_MISR_RESET_ADDR A:0x78b2064
y.create.l HWIO_BLSP1_BLSP_UART3_UART_DM_MISR_EXPORT_ADDR A:0x78b2068
y.create.l HWIO_BLSP1_BLSP_UART3_UART_DM_MISR_VAL_ADDR A:0x78b206c
y.create.l HWIO_BLSP1_BLSP_UART3_UART_DM_TF_RF_DEPRECATED_ADDR A:0x78b2070
y.create.l HWIO_BLSP1_BLSP_UART3_UART_DM_TF_RF_2_DEPRECATED_ADDR A:0x78b2074
y.create.l HWIO_BLSP1_BLSP_UART3_UART_DM_TF_RF_3_DEPRECATED_ADDR A:0x78b2078
y.create.l HWIO_BLSP1_BLSP_UART3_UART_DM_TF_RF_4_DEPRECATED_ADDR A:0x78b207c
y.create.l HWIO_BLSP1_BLSP_UART3_UART_DM_SIM_CFG_ADDR A:0x78b2080
y.create.l HWIO_BLSP1_BLSP_UART3_UART_DM_TEST_WR_ADDR_ADDR A:0x78b2084
y.create.l HWIO_BLSP1_BLSP_UART3_UART_DM_TEST_WR_DATA_ADDR A:0x78b2088
y.create.l HWIO_BLSP1_BLSP_UART3_UART_DM_TEST_RD_ADDR_ADDR A:0x78b208c
y.create.l HWIO_BLSP1_BLSP_UART3_UART_DM_TEST_RD_DATA_ADDR A:0x78b2090
y.create.l HWIO_BLSP1_BLSP_UART3_UART_DM_CSR_ADDR A:0x78b20a0
y.create.l HWIO_BLSP1_BLSP_UART3_UART_DM_SR_ADDR A:0x78b20a4
y.create.l HWIO_BLSP1_BLSP_UART3_UART_DM_CR_ADDR A:0x78b20a8
y.create.l HWIO_BLSP1_BLSP_UART3_UART_DM_MISR_ADDR A:0x78b20ac
y.create.l HWIO_BLSP1_BLSP_UART3_UART_DM_IMR_ADDR A:0x78b20b0
y.create.l HWIO_BLSP1_BLSP_UART3_UART_DM_ISR_ADDR A:0x78b20b4
y.create.l HWIO_BLSP1_BLSP_UART3_UART_DM_IRDA_ADDR A:0x78b20b8
y.create.l HWIO_BLSP1_BLSP_UART3_UART_DM_RX_TOTAL_SNAP_ADDR A:0x78b20bc
y.create.l HWIO_BLSP1_BLSP_UART3_UART_DM_WWT_TIMEOUT_ADDR A:0x78b20c0
y.create.l HWIO_BLSP1_BLSP_UART3_UART_DM_CLK_CTRL_ADDR A:0x78b20c4
y.create.l HWIO_BLSP1_BLSP_UART3_UART_DM_BCR_ADDR A:0x78b20c8
y.create.l HWIO_BLSP1_BLSP_UART3_UART_DM_RX_TRANS_CTRL_ADDR A:0x78b20cc
y.create.l HWIO_BLSP1_BLSP_UART3_UART_DM_DMRX_DBG_ADDR A:0x78b20d0
y.create.l HWIO_BLSP1_BLSP_UART3_UART_DM_FSM_STATUS_ADDR A:0x78b20d4
y.create.l HWIO_BLSP1_BLSP_UART3_UART_DM_HW_VERSION_ADDR A:0x78b20d8
y.create.l HWIO_BLSP1_BLSP_UART3_UART_DM_GENERICS_ADDR A:0x78b20dc
y.create.l HWIO_BLSP1_BLSP_UART3_UART_DM_ISR_CLR_ADDR A:0x78b20e0
y.create.l HWIO_BLSP1_BLSP_UART3_UART_DM_TF_ADDR A:0x78b2100
y.create.l HWIO_BLSP1_BLSP_UART3_UART_DM_TF_2_ADDR A:0x78b2104
y.create.l HWIO_BLSP1_BLSP_UART3_UART_DM_TF_3_ADDR A:0x78b2108
y.create.l HWIO_BLSP1_BLSP_UART3_UART_DM_TF_4_ADDR A:0x78b210c
y.create.l HWIO_BLSP1_BLSP_UART3_UART_DM_TF_5_ADDR A:0x78b2110
y.create.l HWIO_BLSP1_BLSP_UART3_UART_DM_TF_6_ADDR A:0x78b2114
y.create.l HWIO_BLSP1_BLSP_UART3_UART_DM_TF_7_ADDR A:0x78b2118
y.create.l HWIO_BLSP1_BLSP_UART3_UART_DM_TF_8_ADDR A:0x78b211c
y.create.l HWIO_BLSP1_BLSP_UART3_UART_DM_TF_9_ADDR A:0x78b2120
y.create.l HWIO_BLSP1_BLSP_UART3_UART_DM_TF_10_ADDR A:0x78b2124
y.create.l HWIO_BLSP1_BLSP_UART3_UART_DM_TF_11_ADDR A:0x78b2128
y.create.l HWIO_BLSP1_BLSP_UART3_UART_DM_TF_12_ADDR A:0x78b212c
y.create.l HWIO_BLSP1_BLSP_UART3_UART_DM_TF_13_ADDR A:0x78b2130
y.create.l HWIO_BLSP1_BLSP_UART3_UART_DM_TF_14_ADDR A:0x78b2134
y.create.l HWIO_BLSP1_BLSP_UART3_UART_DM_TF_15_ADDR A:0x78b2138
y.create.l HWIO_BLSP1_BLSP_UART3_UART_DM_TF_16_ADDR A:0x78b213c
y.create.l HWIO_BLSP1_BLSP_UART3_UART_DM_RF_ADDR A:0x78b2140
y.create.l HWIO_BLSP1_BLSP_UART3_UART_DM_RF_2_ADDR A:0x78b2144
y.create.l HWIO_BLSP1_BLSP_UART3_UART_DM_RF_3_ADDR A:0x78b2148
y.create.l HWIO_BLSP1_BLSP_UART3_UART_DM_RF_4_ADDR A:0x78b214c
y.create.l HWIO_BLSP1_BLSP_UART3_UART_DM_RF_5_ADDR A:0x78b2150
y.create.l HWIO_BLSP1_BLSP_UART3_UART_DM_RF_6_ADDR A:0x78b2154
y.create.l HWIO_BLSP1_BLSP_UART3_UART_DM_RF_7_ADDR A:0x78b2158
y.create.l HWIO_BLSP1_BLSP_UART3_UART_DM_RF_8_ADDR A:0x78b215c
y.create.l HWIO_BLSP1_BLSP_UART3_UART_DM_RF_9_ADDR A:0x78b2160
y.create.l HWIO_BLSP1_BLSP_UART3_UART_DM_RF_10_ADDR A:0x78b2164
y.create.l HWIO_BLSP1_BLSP_UART3_UART_DM_RF_11_ADDR A:0x78b2168
y.create.l HWIO_BLSP1_BLSP_UART3_UART_DM_RF_12_ADDR A:0x78b216c
y.create.l HWIO_BLSP1_BLSP_UART3_UART_DM_RF_13_ADDR A:0x78b2170
y.create.l HWIO_BLSP1_BLSP_UART3_UART_DM_RF_14_ADDR A:0x78b2174
y.create.l HWIO_BLSP1_BLSP_UART3_UART_DM_RF_15_ADDR A:0x78b2178
y.create.l HWIO_BLSP1_BLSP_UART3_UART_DM_RF_16_ADDR A:0x78b217c
y.create.l HWIO_BLSP1_BLSP_UART3_UART_DM_UIM_CFG_ADDR A:0x78b2180
y.create.l HWIO_BLSP1_BLSP_UART3_UART_DM_UIM_CMD_ADDR A:0x78b2184
y.create.l HWIO_BLSP1_BLSP_UART3_UART_DM_UIM_IO_STATUS_ADDR A:0x78b2188
y.create.l HWIO_BLSP1_BLSP_UART3_UART_DM_UIM_IRQ_ISR_ADDR A:0x78b218c
y.create.l HWIO_BLSP1_BLSP_UART3_UART_DM_UIM_IRQ_MISR_ADDR A:0x78b2190
y.create.l HWIO_BLSP1_BLSP_UART3_UART_DM_UIM_IRQ_CLR_ADDR A:0x78b2194
y.create.l HWIO_BLSP1_BLSP_UART3_UART_DM_UIM_IRQ_IMR_ADDR A:0x78b2198
y.create.l HWIO_BLSP1_BLSP_UART3_UART_DM_UIM_IRQ_IMR_SET_ADDR A:0x78b219c
y.create.l HWIO_BLSP1_BLSP_UART3_UART_DM_UIM_IRQ_IMR_CLR_ADDR A:0x78b21a0
y.create.l HWIO_BLSP1_BLSP_UART4_UART_DM_MR1_ADDR A:0x78b3000
y.create.l HWIO_BLSP1_BLSP_UART4_UART_DM_MR2_ADDR A:0x78b3004
y.create.l HWIO_BLSP1_BLSP_UART4_UART_DM_CSR_SR_DEPRECATED_ADDR A:0x78b3008
y.create.l HWIO_BLSP1_BLSP_UART4_UART_DM_CR_MISR_DEPRECATED_ADDR A:0x78b3010
y.create.l HWIO_BLSP1_BLSP_UART4_UART_DM_IMR_ISR_DEPRECATED_ADDR A:0x78b3014
y.create.l HWIO_BLSP1_BLSP_UART4_UART_DM_IPR_ADDR A:0x78b3018
y.create.l HWIO_BLSP1_BLSP_UART4_UART_DM_TFWR_ADDR A:0x78b301c
y.create.l HWIO_BLSP1_BLSP_UART4_UART_DM_RFWR_ADDR A:0x78b3020
y.create.l HWIO_BLSP1_BLSP_UART4_UART_DM_HCR_ADDR A:0x78b3024
y.create.l HWIO_BLSP1_BLSP_UART4_UART_DM_DMRX_ADDR A:0x78b3034
y.create.l HWIO_BLSP1_BLSP_UART4_UART_DM_IRDA_RX_TOTAL_SNAP_DEPRECATED_ADDR A:0x78b3038
y.create.l HWIO_BLSP1_BLSP_UART4_UART_DM_DMEN_ADDR A:0x78b303c
y.create.l HWIO_BLSP1_BLSP_UART4_UART_DM_NO_CHARS_FOR_TX_ADDR A:0x78b3040
y.create.l HWIO_BLSP1_BLSP_UART4_UART_DM_BADR_ADDR A:0x78b3044
y.create.l HWIO_BLSP1_BLSP_UART4_UART_DM_TESTSL_ADDR A:0x78b3048
y.create.l HWIO_BLSP1_BLSP_UART4_UART_DM_TXFS_ADDR A:0x78b304c
y.create.l HWIO_BLSP1_BLSP_UART4_UART_DM_RXFS_ADDR A:0x78b3050
y.create.l HWIO_BLSP1_BLSP_UART4_UART_DM_MISR_MODE_ADDR A:0x78b3060
y.create.l HWIO_BLSP1_BLSP_UART4_UART_DM_MISR_RESET_ADDR A:0x78b3064
y.create.l HWIO_BLSP1_BLSP_UART4_UART_DM_MISR_EXPORT_ADDR A:0x78b3068
y.create.l HWIO_BLSP1_BLSP_UART4_UART_DM_MISR_VAL_ADDR A:0x78b306c
y.create.l HWIO_BLSP1_BLSP_UART4_UART_DM_TF_RF_DEPRECATED_ADDR A:0x78b3070
y.create.l HWIO_BLSP1_BLSP_UART4_UART_DM_TF_RF_2_DEPRECATED_ADDR A:0x78b3074
y.create.l HWIO_BLSP1_BLSP_UART4_UART_DM_TF_RF_3_DEPRECATED_ADDR A:0x78b3078
y.create.l HWIO_BLSP1_BLSP_UART4_UART_DM_TF_RF_4_DEPRECATED_ADDR A:0x78b307c
y.create.l HWIO_BLSP1_BLSP_UART4_UART_DM_SIM_CFG_ADDR A:0x78b3080
y.create.l HWIO_BLSP1_BLSP_UART4_UART_DM_TEST_WR_ADDR_ADDR A:0x78b3084
y.create.l HWIO_BLSP1_BLSP_UART4_UART_DM_TEST_WR_DATA_ADDR A:0x78b3088
y.create.l HWIO_BLSP1_BLSP_UART4_UART_DM_TEST_RD_ADDR_ADDR A:0x78b308c
y.create.l HWIO_BLSP1_BLSP_UART4_UART_DM_TEST_RD_DATA_ADDR A:0x78b3090
y.create.l HWIO_BLSP1_BLSP_UART4_UART_DM_CSR_ADDR A:0x78b30a0
y.create.l HWIO_BLSP1_BLSP_UART4_UART_DM_SR_ADDR A:0x78b30a4
y.create.l HWIO_BLSP1_BLSP_UART4_UART_DM_CR_ADDR A:0x78b30a8
y.create.l HWIO_BLSP1_BLSP_UART4_UART_DM_MISR_ADDR A:0x78b30ac
y.create.l HWIO_BLSP1_BLSP_UART4_UART_DM_IMR_ADDR A:0x78b30b0
y.create.l HWIO_BLSP1_BLSP_UART4_UART_DM_ISR_ADDR A:0x78b30b4
y.create.l HWIO_BLSP1_BLSP_UART4_UART_DM_IRDA_ADDR A:0x78b30b8
y.create.l HWIO_BLSP1_BLSP_UART4_UART_DM_RX_TOTAL_SNAP_ADDR A:0x78b30bc
y.create.l HWIO_BLSP1_BLSP_UART4_UART_DM_WWT_TIMEOUT_ADDR A:0x78b30c0
y.create.l HWIO_BLSP1_BLSP_UART4_UART_DM_CLK_CTRL_ADDR A:0x78b30c4
y.create.l HWIO_BLSP1_BLSP_UART4_UART_DM_BCR_ADDR A:0x78b30c8
y.create.l HWIO_BLSP1_BLSP_UART4_UART_DM_RX_TRANS_CTRL_ADDR A:0x78b30cc
y.create.l HWIO_BLSP1_BLSP_UART4_UART_DM_DMRX_DBG_ADDR A:0x78b30d0
y.create.l HWIO_BLSP1_BLSP_UART4_UART_DM_FSM_STATUS_ADDR A:0x78b30d4
y.create.l HWIO_BLSP1_BLSP_UART4_UART_DM_HW_VERSION_ADDR A:0x78b30d8
y.create.l HWIO_BLSP1_BLSP_UART4_UART_DM_GENERICS_ADDR A:0x78b30dc
y.create.l HWIO_BLSP1_BLSP_UART4_UART_DM_ISR_CLR_ADDR A:0x78b30e0
y.create.l HWIO_BLSP1_BLSP_UART4_UART_DM_TF_ADDR A:0x78b3100
y.create.l HWIO_BLSP1_BLSP_UART4_UART_DM_TF_2_ADDR A:0x78b3104
y.create.l HWIO_BLSP1_BLSP_UART4_UART_DM_TF_3_ADDR A:0x78b3108
y.create.l HWIO_BLSP1_BLSP_UART4_UART_DM_TF_4_ADDR A:0x78b310c
y.create.l HWIO_BLSP1_BLSP_UART4_UART_DM_TF_5_ADDR A:0x78b3110
y.create.l HWIO_BLSP1_BLSP_UART4_UART_DM_TF_6_ADDR A:0x78b3114
y.create.l HWIO_BLSP1_BLSP_UART4_UART_DM_TF_7_ADDR A:0x78b3118
y.create.l HWIO_BLSP1_BLSP_UART4_UART_DM_TF_8_ADDR A:0x78b311c
y.create.l HWIO_BLSP1_BLSP_UART4_UART_DM_TF_9_ADDR A:0x78b3120
y.create.l HWIO_BLSP1_BLSP_UART4_UART_DM_TF_10_ADDR A:0x78b3124
y.create.l HWIO_BLSP1_BLSP_UART4_UART_DM_TF_11_ADDR A:0x78b3128
y.create.l HWIO_BLSP1_BLSP_UART4_UART_DM_TF_12_ADDR A:0x78b312c
y.create.l HWIO_BLSP1_BLSP_UART4_UART_DM_TF_13_ADDR A:0x78b3130
y.create.l HWIO_BLSP1_BLSP_UART4_UART_DM_TF_14_ADDR A:0x78b3134
y.create.l HWIO_BLSP1_BLSP_UART4_UART_DM_TF_15_ADDR A:0x78b3138
y.create.l HWIO_BLSP1_BLSP_UART4_UART_DM_TF_16_ADDR A:0x78b313c
y.create.l HWIO_BLSP1_BLSP_UART4_UART_DM_RF_ADDR A:0x78b3140
y.create.l HWIO_BLSP1_BLSP_UART4_UART_DM_RF_2_ADDR A:0x78b3144
y.create.l HWIO_BLSP1_BLSP_UART4_UART_DM_RF_3_ADDR A:0x78b3148
y.create.l HWIO_BLSP1_BLSP_UART4_UART_DM_RF_4_ADDR A:0x78b314c
y.create.l HWIO_BLSP1_BLSP_UART4_UART_DM_RF_5_ADDR A:0x78b3150
y.create.l HWIO_BLSP1_BLSP_UART4_UART_DM_RF_6_ADDR A:0x78b3154
y.create.l HWIO_BLSP1_BLSP_UART4_UART_DM_RF_7_ADDR A:0x78b3158
y.create.l HWIO_BLSP1_BLSP_UART4_UART_DM_RF_8_ADDR A:0x78b315c
y.create.l HWIO_BLSP1_BLSP_UART4_UART_DM_RF_9_ADDR A:0x78b3160
y.create.l HWIO_BLSP1_BLSP_UART4_UART_DM_RF_10_ADDR A:0x78b3164
y.create.l HWIO_BLSP1_BLSP_UART4_UART_DM_RF_11_ADDR A:0x78b3168
y.create.l HWIO_BLSP1_BLSP_UART4_UART_DM_RF_12_ADDR A:0x78b316c
y.create.l HWIO_BLSP1_BLSP_UART4_UART_DM_RF_13_ADDR A:0x78b3170
y.create.l HWIO_BLSP1_BLSP_UART4_UART_DM_RF_14_ADDR A:0x78b3174
y.create.l HWIO_BLSP1_BLSP_UART4_UART_DM_RF_15_ADDR A:0x78b3178
y.create.l HWIO_BLSP1_BLSP_UART4_UART_DM_RF_16_ADDR A:0x78b317c
y.create.l HWIO_BLSP1_BLSP_UART4_UART_DM_UIM_CFG_ADDR A:0x78b3180
y.create.l HWIO_BLSP1_BLSP_UART4_UART_DM_UIM_CMD_ADDR A:0x78b3184
y.create.l HWIO_BLSP1_BLSP_UART4_UART_DM_UIM_IO_STATUS_ADDR A:0x78b3188
y.create.l HWIO_BLSP1_BLSP_UART4_UART_DM_UIM_IRQ_ISR_ADDR A:0x78b318c
y.create.l HWIO_BLSP1_BLSP_UART4_UART_DM_UIM_IRQ_MISR_ADDR A:0x78b3190
y.create.l HWIO_BLSP1_BLSP_UART4_UART_DM_UIM_IRQ_CLR_ADDR A:0x78b3194
y.create.l HWIO_BLSP1_BLSP_UART4_UART_DM_UIM_IRQ_IMR_ADDR A:0x78b3198
y.create.l HWIO_BLSP1_BLSP_UART4_UART_DM_UIM_IRQ_IMR_SET_ADDR A:0x78b319c
y.create.l HWIO_BLSP1_BLSP_UART4_UART_DM_UIM_IRQ_IMR_CLR_ADDR A:0x78b31a0
y.create.l HWIO_BLSP1_BLSP_UART5_UART_DM_MR1_ADDR A:0x78b4000
y.create.l HWIO_BLSP1_BLSP_UART5_UART_DM_MR2_ADDR A:0x78b4004
y.create.l HWIO_BLSP1_BLSP_UART5_UART_DM_CSR_SR_DEPRECATED_ADDR A:0x78b4008
y.create.l HWIO_BLSP1_BLSP_UART5_UART_DM_CR_MISR_DEPRECATED_ADDR A:0x78b4010
y.create.l HWIO_BLSP1_BLSP_UART5_UART_DM_IMR_ISR_DEPRECATED_ADDR A:0x78b4014
y.create.l HWIO_BLSP1_BLSP_UART5_UART_DM_IPR_ADDR A:0x78b4018
y.create.l HWIO_BLSP1_BLSP_UART5_UART_DM_TFWR_ADDR A:0x78b401c
y.create.l HWIO_BLSP1_BLSP_UART5_UART_DM_RFWR_ADDR A:0x78b4020
y.create.l HWIO_BLSP1_BLSP_UART5_UART_DM_HCR_ADDR A:0x78b4024
y.create.l HWIO_BLSP1_BLSP_UART5_UART_DM_DMRX_ADDR A:0x78b4034
y.create.l HWIO_BLSP1_BLSP_UART5_UART_DM_IRDA_RX_TOTAL_SNAP_DEPRECATED_ADDR A:0x78b4038
y.create.l HWIO_BLSP1_BLSP_UART5_UART_DM_DMEN_ADDR A:0x78b403c
y.create.l HWIO_BLSP1_BLSP_UART5_UART_DM_NO_CHARS_FOR_TX_ADDR A:0x78b4040
y.create.l HWIO_BLSP1_BLSP_UART5_UART_DM_BADR_ADDR A:0x78b4044
y.create.l HWIO_BLSP1_BLSP_UART5_UART_DM_TESTSL_ADDR A:0x78b4048
y.create.l HWIO_BLSP1_BLSP_UART5_UART_DM_TXFS_ADDR A:0x78b404c
y.create.l HWIO_BLSP1_BLSP_UART5_UART_DM_RXFS_ADDR A:0x78b4050
y.create.l HWIO_BLSP1_BLSP_UART5_UART_DM_MISR_MODE_ADDR A:0x78b4060
y.create.l HWIO_BLSP1_BLSP_UART5_UART_DM_MISR_RESET_ADDR A:0x78b4064
y.create.l HWIO_BLSP1_BLSP_UART5_UART_DM_MISR_EXPORT_ADDR A:0x78b4068
y.create.l HWIO_BLSP1_BLSP_UART5_UART_DM_MISR_VAL_ADDR A:0x78b406c
y.create.l HWIO_BLSP1_BLSP_UART5_UART_DM_TF_RF_DEPRECATED_ADDR A:0x78b4070
y.create.l HWIO_BLSP1_BLSP_UART5_UART_DM_TF_RF_2_DEPRECATED_ADDR A:0x78b4074
y.create.l HWIO_BLSP1_BLSP_UART5_UART_DM_TF_RF_3_DEPRECATED_ADDR A:0x78b4078
y.create.l HWIO_BLSP1_BLSP_UART5_UART_DM_TF_RF_4_DEPRECATED_ADDR A:0x78b407c
y.create.l HWIO_BLSP1_BLSP_UART5_UART_DM_SIM_CFG_ADDR A:0x78b4080
y.create.l HWIO_BLSP1_BLSP_UART5_UART_DM_TEST_WR_ADDR_ADDR A:0x78b4084
y.create.l HWIO_BLSP1_BLSP_UART5_UART_DM_TEST_WR_DATA_ADDR A:0x78b4088
y.create.l HWIO_BLSP1_BLSP_UART5_UART_DM_TEST_RD_ADDR_ADDR A:0x78b408c
y.create.l HWIO_BLSP1_BLSP_UART5_UART_DM_TEST_RD_DATA_ADDR A:0x78b4090
y.create.l HWIO_BLSP1_BLSP_UART5_UART_DM_CSR_ADDR A:0x78b40a0
y.create.l HWIO_BLSP1_BLSP_UART5_UART_DM_SR_ADDR A:0x78b40a4
y.create.l HWIO_BLSP1_BLSP_UART5_UART_DM_CR_ADDR A:0x78b40a8
y.create.l HWIO_BLSP1_BLSP_UART5_UART_DM_MISR_ADDR A:0x78b40ac
y.create.l HWIO_BLSP1_BLSP_UART5_UART_DM_IMR_ADDR A:0x78b40b0
y.create.l HWIO_BLSP1_BLSP_UART5_UART_DM_ISR_ADDR A:0x78b40b4
y.create.l HWIO_BLSP1_BLSP_UART5_UART_DM_IRDA_ADDR A:0x78b40b8
y.create.l HWIO_BLSP1_BLSP_UART5_UART_DM_RX_TOTAL_SNAP_ADDR A:0x78b40bc
y.create.l HWIO_BLSP1_BLSP_UART5_UART_DM_WWT_TIMEOUT_ADDR A:0x78b40c0
y.create.l HWIO_BLSP1_BLSP_UART5_UART_DM_CLK_CTRL_ADDR A:0x78b40c4
y.create.l HWIO_BLSP1_BLSP_UART5_UART_DM_BCR_ADDR A:0x78b40c8
y.create.l HWIO_BLSP1_BLSP_UART5_UART_DM_RX_TRANS_CTRL_ADDR A:0x78b40cc
y.create.l HWIO_BLSP1_BLSP_UART5_UART_DM_DMRX_DBG_ADDR A:0x78b40d0
y.create.l HWIO_BLSP1_BLSP_UART5_UART_DM_FSM_STATUS_ADDR A:0x78b40d4
y.create.l HWIO_BLSP1_BLSP_UART5_UART_DM_HW_VERSION_ADDR A:0x78b40d8
y.create.l HWIO_BLSP1_BLSP_UART5_UART_DM_GENERICS_ADDR A:0x78b40dc
y.create.l HWIO_BLSP1_BLSP_UART5_UART_DM_ISR_CLR_ADDR A:0x78b40e0
y.create.l HWIO_BLSP1_BLSP_UART5_UART_DM_TF_ADDR A:0x78b4100
y.create.l HWIO_BLSP1_BLSP_UART5_UART_DM_TF_2_ADDR A:0x78b4104
y.create.l HWIO_BLSP1_BLSP_UART5_UART_DM_TF_3_ADDR A:0x78b4108
y.create.l HWIO_BLSP1_BLSP_UART5_UART_DM_TF_4_ADDR A:0x78b410c
y.create.l HWIO_BLSP1_BLSP_UART5_UART_DM_TF_5_ADDR A:0x78b4110
y.create.l HWIO_BLSP1_BLSP_UART5_UART_DM_TF_6_ADDR A:0x78b4114
y.create.l HWIO_BLSP1_BLSP_UART5_UART_DM_TF_7_ADDR A:0x78b4118
y.create.l HWIO_BLSP1_BLSP_UART5_UART_DM_TF_8_ADDR A:0x78b411c
y.create.l HWIO_BLSP1_BLSP_UART5_UART_DM_TF_9_ADDR A:0x78b4120
y.create.l HWIO_BLSP1_BLSP_UART5_UART_DM_TF_10_ADDR A:0x78b4124
y.create.l HWIO_BLSP1_BLSP_UART5_UART_DM_TF_11_ADDR A:0x78b4128
y.create.l HWIO_BLSP1_BLSP_UART5_UART_DM_TF_12_ADDR A:0x78b412c
y.create.l HWIO_BLSP1_BLSP_UART5_UART_DM_TF_13_ADDR A:0x78b4130
y.create.l HWIO_BLSP1_BLSP_UART5_UART_DM_TF_14_ADDR A:0x78b4134
y.create.l HWIO_BLSP1_BLSP_UART5_UART_DM_TF_15_ADDR A:0x78b4138
y.create.l HWIO_BLSP1_BLSP_UART5_UART_DM_TF_16_ADDR A:0x78b413c
y.create.l HWIO_BLSP1_BLSP_UART5_UART_DM_RF_ADDR A:0x78b4140
y.create.l HWIO_BLSP1_BLSP_UART5_UART_DM_RF_2_ADDR A:0x78b4144
y.create.l HWIO_BLSP1_BLSP_UART5_UART_DM_RF_3_ADDR A:0x78b4148
y.create.l HWIO_BLSP1_BLSP_UART5_UART_DM_RF_4_ADDR A:0x78b414c
y.create.l HWIO_BLSP1_BLSP_UART5_UART_DM_RF_5_ADDR A:0x78b4150
y.create.l HWIO_BLSP1_BLSP_UART5_UART_DM_RF_6_ADDR A:0x78b4154
y.create.l HWIO_BLSP1_BLSP_UART5_UART_DM_RF_7_ADDR A:0x78b4158
y.create.l HWIO_BLSP1_BLSP_UART5_UART_DM_RF_8_ADDR A:0x78b415c
y.create.l HWIO_BLSP1_BLSP_UART5_UART_DM_RF_9_ADDR A:0x78b4160
y.create.l HWIO_BLSP1_BLSP_UART5_UART_DM_RF_10_ADDR A:0x78b4164
y.create.l HWIO_BLSP1_BLSP_UART5_UART_DM_RF_11_ADDR A:0x78b4168
y.create.l HWIO_BLSP1_BLSP_UART5_UART_DM_RF_12_ADDR A:0x78b416c
y.create.l HWIO_BLSP1_BLSP_UART5_UART_DM_RF_13_ADDR A:0x78b4170
y.create.l HWIO_BLSP1_BLSP_UART5_UART_DM_RF_14_ADDR A:0x78b4174
y.create.l HWIO_BLSP1_BLSP_UART5_UART_DM_RF_15_ADDR A:0x78b4178
y.create.l HWIO_BLSP1_BLSP_UART5_UART_DM_RF_16_ADDR A:0x78b417c
y.create.l HWIO_BLSP1_BLSP_UART5_UART_DM_UIM_CFG_ADDR A:0x78b4180
y.create.l HWIO_BLSP1_BLSP_UART5_UART_DM_UIM_CMD_ADDR A:0x78b4184
y.create.l HWIO_BLSP1_BLSP_UART5_UART_DM_UIM_IO_STATUS_ADDR A:0x78b4188
y.create.l HWIO_BLSP1_BLSP_UART5_UART_DM_UIM_IRQ_ISR_ADDR A:0x78b418c
y.create.l HWIO_BLSP1_BLSP_UART5_UART_DM_UIM_IRQ_MISR_ADDR A:0x78b4190
y.create.l HWIO_BLSP1_BLSP_UART5_UART_DM_UIM_IRQ_CLR_ADDR A:0x78b4194
y.create.l HWIO_BLSP1_BLSP_UART5_UART_DM_UIM_IRQ_IMR_ADDR A:0x78b4198
y.create.l HWIO_BLSP1_BLSP_UART5_UART_DM_UIM_IRQ_IMR_SET_ADDR A:0x78b419c
y.create.l HWIO_BLSP1_BLSP_UART5_UART_DM_UIM_IRQ_IMR_CLR_ADDR A:0x78b41a0
y.create.l HWIO_BLSP1_BLSP_QUP0_QUP_CONFIG_ADDR A:0x78b5000
y.create.l HWIO_BLSP1_BLSP_QUP0_QUP_STATE_ADDR A:0x78b5004
y.create.l HWIO_BLSP1_BLSP_QUP0_QUP_IO_MODES_ADDR A:0x78b5008
y.create.l HWIO_BLSP1_BLSP_QUP0_QUP_SW_RESET_ADDR A:0x78b500c
y.create.l HWIO_BLSP1_BLSP_QUP0_QUP_TRANSFER_CANCEL_ADDR A:0x78b5014
y.create.l HWIO_BLSP1_BLSP_QUP0_QUP_OPERATIONAL_ADDR A:0x78b5018
y.create.l HWIO_BLSP1_BLSP_QUP0_QUP_ERROR_FLAGS_ADDR A:0x78b501c
y.create.l HWIO_BLSP1_BLSP_QUP0_QUP_ERROR_FLAGS_EN_ADDR A:0x78b5020
y.create.l HWIO_BLSP1_BLSP_QUP0_QUP_TEST_CTRL_ADDR A:0x78b5024
y.create.l HWIO_BLSP1_BLSP_QUP0_QUP_OPERATIONAL_MASK_ADDR A:0x78b5028
y.create.l HWIO_BLSP1_BLSP_QUP0_QUP_HW_VERSION_ADDR A:0x78b5030
y.create.l HWIO_BLSP1_BLSP_QUP0_QUP_MX_OUTPUT_COUNT_ADDR A:0x78b5100
y.create.l HWIO_BLSP1_BLSP_QUP0_QUP_MX_OUTPUT_CNT_CURRENT_ADDR A:0x78b5104
y.create.l HWIO_BLSP1_BLSP_QUP0_QUP_OUTPUT_DEBUG_ADDR A:0x78b5108
y.create.l HWIO_BLSP1_BLSP_QUP0_QUP_OUTPUT_FIFO_WORD_CNT_ADDR A:0x78b510c
y.create.l HWIO_BLSP1_BLSP_QUP0_QUP_OUTPUT_FIFO0_ADDR A:0x78b5110
y.create.l HWIO_BLSP1_BLSP_QUP0_QUP_OUTPUT_FIFO1_ADDR A:0x78b5114
y.create.l HWIO_BLSP1_BLSP_QUP0_QUP_OUTPUT_FIFO2_ADDR A:0x78b5118
y.create.l HWIO_BLSP1_BLSP_QUP0_QUP_OUTPUT_FIFO3_ADDR A:0x78b511c
y.create.l HWIO_BLSP1_BLSP_QUP0_QUP_OUTPUT_FIFO4_ADDR A:0x78b5120
y.create.l HWIO_BLSP1_BLSP_QUP0_QUP_OUTPUT_FIFO5_ADDR A:0x78b5124
y.create.l HWIO_BLSP1_BLSP_QUP0_QUP_OUTPUT_FIFO6_ADDR A:0x78b5128
y.create.l HWIO_BLSP1_BLSP_QUP0_QUP_OUTPUT_FIFO7_ADDR A:0x78b512c
y.create.l HWIO_BLSP1_BLSP_QUP0_QUP_OUTPUT_FIFO8_ADDR A:0x78b5130
y.create.l HWIO_BLSP1_BLSP_QUP0_QUP_OUTPUT_FIFO9_ADDR A:0x78b5134
y.create.l HWIO_BLSP1_BLSP_QUP0_QUP_MX_WRITE_COUNT_ADDR A:0x78b5150
y.create.l HWIO_BLSP1_BLSP_QUP0_QUP_MX_WRITE_CNT_CURRENT_ADDR A:0x78b5154
y.create.l HWIO_BLSP1_BLSP_QUP0_QUP_MX_INPUT_COUNT_ADDR A:0x78b5200
y.create.l HWIO_BLSP1_BLSP_QUP0_QUP_MX_INPUT_CNT_CURRENT_ADDR A:0x78b5204
y.create.l HWIO_BLSP1_BLSP_QUP0_QUP_MX_READ_COUNT_ADDR A:0x78b5208
y.create.l HWIO_BLSP1_BLSP_QUP0_QUP_MX_READ_CNT_CURRENT_ADDR A:0x78b520c
y.create.l HWIO_BLSP1_BLSP_QUP0_QUP_INPUT_DEBUG_ADDR A:0x78b5210
y.create.l HWIO_BLSP1_BLSP_QUP0_QUP_INPUT_FIFO_WORD_CNT_ADDR A:0x78b5214
y.create.l HWIO_BLSP1_BLSP_QUP0_QUP_INPUT_FIFO0_ADDR A:0x78b5218
y.create.l HWIO_BLSP1_BLSP_QUP0_QUP_INPUT_FIFO1_ADDR A:0x78b521c
y.create.l HWIO_BLSP1_BLSP_QUP0_QUP_INPUT_FIFO2_ADDR A:0x78b5220
y.create.l HWIO_BLSP1_BLSP_QUP0_QUP_INPUT_FIFO3_ADDR A:0x78b5224
y.create.l HWIO_BLSP1_BLSP_QUP0_QUP_INPUT_FIFO4_ADDR A:0x78b5228
y.create.l HWIO_BLSP1_BLSP_QUP0_QUP_INPUT_FIFO5_ADDR A:0x78b522c
y.create.l HWIO_BLSP1_BLSP_QUP0_QUP_INPUT_FIFO6_ADDR A:0x78b5230
y.create.l HWIO_BLSP1_BLSP_QUP0_QUP_INPUT_FIFO7_ADDR A:0x78b5234
y.create.l HWIO_BLSP1_BLSP_QUP0_QUP_INPUT_FIFO8_ADDR A:0x78b5238
y.create.l HWIO_BLSP1_BLSP_QUP0_QUP_INPUT_FIFO9_ADDR A:0x78b523c
y.create.l HWIO_BLSP1_BLSP_QUP0_SPI_CONFIG_ADDR A:0x78b5300
y.create.l HWIO_BLSP1_BLSP_QUP0_SPI_IO_CONTROL_ADDR A:0x78b5304
y.create.l HWIO_BLSP1_BLSP_QUP0_SPI_ERROR_FLAGS_ADDR A:0x78b5308
y.create.l HWIO_BLSP1_BLSP_QUP0_SPI_ERROR_FLAGS_EN_ADDR A:0x78b530c
y.create.l HWIO_BLSP1_BLSP_QUP0_SPI_DEASSERT_WAIT_ADDR A:0x78b5310
y.create.l HWIO_BLSP1_BLSP_QUP0_SPI_MASTER_LOCAL_ID_ADDR A:0x78b5314
y.create.l HWIO_BLSP1_BLSP_QUP0_SPI_MASTER_COMMAND_ADDR A:0x78b5318
y.create.l HWIO_BLSP1_BLSP_QUP0_SPI_MASTER_STATUS_ADDR A:0x78b531c
y.create.l HWIO_BLSP1_BLSP_QUP0_SPI_CHAR_CFG_ADDR A:0x78b5320
y.create.l HWIO_BLSP1_BLSP_QUP0_SPI_CHAR_DATA_SPI_CS_ADDR A:0x78b5324
y.create.l HWIO_BLSP1_BLSP_QUP0_SPI_CHAR_DATA_SPI_MOSI_ADDR A:0x78b5328
y.create.l HWIO_BLSP1_BLSP_QUP0_SPI_CHAR_DATA_SPI_MISO_ADDR A:0x78b532c
y.create.l HWIO_BLSP1_BLSP_QUP0_SPI_SLAVE_IRQ_STATUS_ADDR A:0x78b5330
y.create.l HWIO_BLSP1_BLSP_QUP0_SPI_SLAVE_IRQ_EN_ADDR A:0x78b5334
y.create.l HWIO_BLSP1_BLSP_QUP0_SPI_SLAVE_CFG_ADDR A:0x78b5338
y.create.l HWIO_BLSP1_BLSP_QUP0_SPI_SLAVE_DEBUG_ADDR A:0x78b533c
y.create.l HWIO_BLSP1_BLSP_QUP0_I2C_MASTER_CLK_CTL_ADDR A:0x78b5400
y.create.l HWIO_BLSP1_BLSP_QUP0_I2C_MASTER_STATUS_ADDR A:0x78b5404
y.create.l HWIO_BLSP1_BLSP_QUP0_I2C_MASTER_CONFIG_ADDR A:0x78b5408
y.create.l HWIO_BLSP1_BLSP_QUP0_I2C_MASTER_BUS_CLEAR_ADDR A:0x78b540c
y.create.l HWIO_BLSP1_BLSP_QUP0_I2C_MASTER_LOCAL_ID_ADDR A:0x78b5410
y.create.l HWIO_BLSP1_BLSP_QUP0_I2C_MASTER_COMMAND_ADDR A:0x78b5414
y.create.l HWIO_BLSP1_BLSP_QUP1_QUP_CONFIG_ADDR A:0x78b6000
y.create.l HWIO_BLSP1_BLSP_QUP1_QUP_STATE_ADDR A:0x78b6004
y.create.l HWIO_BLSP1_BLSP_QUP1_QUP_IO_MODES_ADDR A:0x78b6008
y.create.l HWIO_BLSP1_BLSP_QUP1_QUP_SW_RESET_ADDR A:0x78b600c
y.create.l HWIO_BLSP1_BLSP_QUP1_QUP_TRANSFER_CANCEL_ADDR A:0x78b6014
y.create.l HWIO_BLSP1_BLSP_QUP1_QUP_OPERATIONAL_ADDR A:0x78b6018
y.create.l HWIO_BLSP1_BLSP_QUP1_QUP_ERROR_FLAGS_ADDR A:0x78b601c
y.create.l HWIO_BLSP1_BLSP_QUP1_QUP_ERROR_FLAGS_EN_ADDR A:0x78b6020
y.create.l HWIO_BLSP1_BLSP_QUP1_QUP_TEST_CTRL_ADDR A:0x78b6024
y.create.l HWIO_BLSP1_BLSP_QUP1_QUP_OPERATIONAL_MASK_ADDR A:0x78b6028
y.create.l HWIO_BLSP1_BLSP_QUP1_QUP_HW_VERSION_ADDR A:0x78b6030
y.create.l HWIO_BLSP1_BLSP_QUP1_QUP_MX_OUTPUT_COUNT_ADDR A:0x78b6100
y.create.l HWIO_BLSP1_BLSP_QUP1_QUP_MX_OUTPUT_CNT_CURRENT_ADDR A:0x78b6104
y.create.l HWIO_BLSP1_BLSP_QUP1_QUP_OUTPUT_DEBUG_ADDR A:0x78b6108
y.create.l HWIO_BLSP1_BLSP_QUP1_QUP_OUTPUT_FIFO_WORD_CNT_ADDR A:0x78b610c
y.create.l HWIO_BLSP1_BLSP_QUP1_QUP_OUTPUT_FIFO0_ADDR A:0x78b6110
y.create.l HWIO_BLSP1_BLSP_QUP1_QUP_OUTPUT_FIFO1_ADDR A:0x78b6114
y.create.l HWIO_BLSP1_BLSP_QUP1_QUP_OUTPUT_FIFO2_ADDR A:0x78b6118
y.create.l HWIO_BLSP1_BLSP_QUP1_QUP_OUTPUT_FIFO3_ADDR A:0x78b611c
y.create.l HWIO_BLSP1_BLSP_QUP1_QUP_OUTPUT_FIFO4_ADDR A:0x78b6120
y.create.l HWIO_BLSP1_BLSP_QUP1_QUP_OUTPUT_FIFO5_ADDR A:0x78b6124
y.create.l HWIO_BLSP1_BLSP_QUP1_QUP_OUTPUT_FIFO6_ADDR A:0x78b6128
y.create.l HWIO_BLSP1_BLSP_QUP1_QUP_OUTPUT_FIFO7_ADDR A:0x78b612c
y.create.l HWIO_BLSP1_BLSP_QUP1_QUP_OUTPUT_FIFO8_ADDR A:0x78b6130
y.create.l HWIO_BLSP1_BLSP_QUP1_QUP_OUTPUT_FIFO9_ADDR A:0x78b6134
y.create.l HWIO_BLSP1_BLSP_QUP1_QUP_MX_WRITE_COUNT_ADDR A:0x78b6150
y.create.l HWIO_BLSP1_BLSP_QUP1_QUP_MX_WRITE_CNT_CURRENT_ADDR A:0x78b6154
y.create.l HWIO_BLSP1_BLSP_QUP1_QUP_MX_INPUT_COUNT_ADDR A:0x78b6200
y.create.l HWIO_BLSP1_BLSP_QUP1_QUP_MX_INPUT_CNT_CURRENT_ADDR A:0x78b6204
y.create.l HWIO_BLSP1_BLSP_QUP1_QUP_MX_READ_COUNT_ADDR A:0x78b6208
y.create.l HWIO_BLSP1_BLSP_QUP1_QUP_MX_READ_CNT_CURRENT_ADDR A:0x78b620c
y.create.l HWIO_BLSP1_BLSP_QUP1_QUP_INPUT_DEBUG_ADDR A:0x78b6210
y.create.l HWIO_BLSP1_BLSP_QUP1_QUP_INPUT_FIFO_WORD_CNT_ADDR A:0x78b6214
y.create.l HWIO_BLSP1_BLSP_QUP1_QUP_INPUT_FIFO0_ADDR A:0x78b6218
y.create.l HWIO_BLSP1_BLSP_QUP1_QUP_INPUT_FIFO1_ADDR A:0x78b621c
y.create.l HWIO_BLSP1_BLSP_QUP1_QUP_INPUT_FIFO2_ADDR A:0x78b6220
y.create.l HWIO_BLSP1_BLSP_QUP1_QUP_INPUT_FIFO3_ADDR A:0x78b6224
y.create.l HWIO_BLSP1_BLSP_QUP1_QUP_INPUT_FIFO4_ADDR A:0x78b6228
y.create.l HWIO_BLSP1_BLSP_QUP1_QUP_INPUT_FIFO5_ADDR A:0x78b622c
y.create.l HWIO_BLSP1_BLSP_QUP1_QUP_INPUT_FIFO6_ADDR A:0x78b6230
y.create.l HWIO_BLSP1_BLSP_QUP1_QUP_INPUT_FIFO7_ADDR A:0x78b6234
y.create.l HWIO_BLSP1_BLSP_QUP1_QUP_INPUT_FIFO8_ADDR A:0x78b6238
y.create.l HWIO_BLSP1_BLSP_QUP1_QUP_INPUT_FIFO9_ADDR A:0x78b623c
y.create.l HWIO_BLSP1_BLSP_QUP1_SPI_CONFIG_ADDR A:0x78b6300
y.create.l HWIO_BLSP1_BLSP_QUP1_SPI_IO_CONTROL_ADDR A:0x78b6304
y.create.l HWIO_BLSP1_BLSP_QUP1_SPI_ERROR_FLAGS_ADDR A:0x78b6308
y.create.l HWIO_BLSP1_BLSP_QUP1_SPI_ERROR_FLAGS_EN_ADDR A:0x78b630c
y.create.l HWIO_BLSP1_BLSP_QUP1_SPI_DEASSERT_WAIT_ADDR A:0x78b6310
y.create.l HWIO_BLSP1_BLSP_QUP1_SPI_MASTER_LOCAL_ID_ADDR A:0x78b6314
y.create.l HWIO_BLSP1_BLSP_QUP1_SPI_MASTER_COMMAND_ADDR A:0x78b6318
y.create.l HWIO_BLSP1_BLSP_QUP1_SPI_MASTER_STATUS_ADDR A:0x78b631c
y.create.l HWIO_BLSP1_BLSP_QUP1_SPI_CHAR_CFG_ADDR A:0x78b6320
y.create.l HWIO_BLSP1_BLSP_QUP1_SPI_CHAR_DATA_SPI_CS_ADDR A:0x78b6324
y.create.l HWIO_BLSP1_BLSP_QUP1_SPI_CHAR_DATA_SPI_MOSI_ADDR A:0x78b6328
y.create.l HWIO_BLSP1_BLSP_QUP1_SPI_CHAR_DATA_SPI_MISO_ADDR A:0x78b632c
y.create.l HWIO_BLSP1_BLSP_QUP1_SPI_SLAVE_IRQ_STATUS_ADDR A:0x78b6330
y.create.l HWIO_BLSP1_BLSP_QUP1_SPI_SLAVE_IRQ_EN_ADDR A:0x78b6334
y.create.l HWIO_BLSP1_BLSP_QUP1_SPI_SLAVE_CFG_ADDR A:0x78b6338
y.create.l HWIO_BLSP1_BLSP_QUP1_SPI_SLAVE_DEBUG_ADDR A:0x78b633c
y.create.l HWIO_BLSP1_BLSP_QUP1_I2C_MASTER_CLK_CTL_ADDR A:0x78b6400
y.create.l HWIO_BLSP1_BLSP_QUP1_I2C_MASTER_STATUS_ADDR A:0x78b6404
y.create.l HWIO_BLSP1_BLSP_QUP1_I2C_MASTER_CONFIG_ADDR A:0x78b6408
y.create.l HWIO_BLSP1_BLSP_QUP1_I2C_MASTER_BUS_CLEAR_ADDR A:0x78b640c
y.create.l HWIO_BLSP1_BLSP_QUP1_I2C_MASTER_LOCAL_ID_ADDR A:0x78b6410
y.create.l HWIO_BLSP1_BLSP_QUP1_I2C_MASTER_COMMAND_ADDR A:0x78b6414
y.create.l HWIO_BLSP1_BLSP_QUP2_QUP_CONFIG_ADDR A:0x78b7000
y.create.l HWIO_BLSP1_BLSP_QUP2_QUP_STATE_ADDR A:0x78b7004
y.create.l HWIO_BLSP1_BLSP_QUP2_QUP_IO_MODES_ADDR A:0x78b7008
y.create.l HWIO_BLSP1_BLSP_QUP2_QUP_SW_RESET_ADDR A:0x78b700c
y.create.l HWIO_BLSP1_BLSP_QUP2_QUP_TRANSFER_CANCEL_ADDR A:0x78b7014
y.create.l HWIO_BLSP1_BLSP_QUP2_QUP_OPERATIONAL_ADDR A:0x78b7018
y.create.l HWIO_BLSP1_BLSP_QUP2_QUP_ERROR_FLAGS_ADDR A:0x78b701c
y.create.l HWIO_BLSP1_BLSP_QUP2_QUP_ERROR_FLAGS_EN_ADDR A:0x78b7020
y.create.l HWIO_BLSP1_BLSP_QUP2_QUP_TEST_CTRL_ADDR A:0x78b7024
y.create.l HWIO_BLSP1_BLSP_QUP2_QUP_OPERATIONAL_MASK_ADDR A:0x78b7028
y.create.l HWIO_BLSP1_BLSP_QUP2_QUP_HW_VERSION_ADDR A:0x78b7030
y.create.l HWIO_BLSP1_BLSP_QUP2_QUP_MX_OUTPUT_COUNT_ADDR A:0x78b7100
y.create.l HWIO_BLSP1_BLSP_QUP2_QUP_MX_OUTPUT_CNT_CURRENT_ADDR A:0x78b7104
y.create.l HWIO_BLSP1_BLSP_QUP2_QUP_OUTPUT_DEBUG_ADDR A:0x78b7108
y.create.l HWIO_BLSP1_BLSP_QUP2_QUP_OUTPUT_FIFO_WORD_CNT_ADDR A:0x78b710c
y.create.l HWIO_BLSP1_BLSP_QUP2_QUP_OUTPUT_FIFO0_ADDR A:0x78b7110
y.create.l HWIO_BLSP1_BLSP_QUP2_QUP_OUTPUT_FIFO1_ADDR A:0x78b7114
y.create.l HWIO_BLSP1_BLSP_QUP2_QUP_OUTPUT_FIFO2_ADDR A:0x78b7118
y.create.l HWIO_BLSP1_BLSP_QUP2_QUP_OUTPUT_FIFO3_ADDR A:0x78b711c
y.create.l HWIO_BLSP1_BLSP_QUP2_QUP_OUTPUT_FIFO4_ADDR A:0x78b7120
y.create.l HWIO_BLSP1_BLSP_QUP2_QUP_OUTPUT_FIFO5_ADDR A:0x78b7124
y.create.l HWIO_BLSP1_BLSP_QUP2_QUP_OUTPUT_FIFO6_ADDR A:0x78b7128
y.create.l HWIO_BLSP1_BLSP_QUP2_QUP_OUTPUT_FIFO7_ADDR A:0x78b712c
y.create.l HWIO_BLSP1_BLSP_QUP2_QUP_OUTPUT_FIFO8_ADDR A:0x78b7130
y.create.l HWIO_BLSP1_BLSP_QUP2_QUP_OUTPUT_FIFO9_ADDR A:0x78b7134
y.create.l HWIO_BLSP1_BLSP_QUP2_QUP_MX_WRITE_COUNT_ADDR A:0x78b7150
y.create.l HWIO_BLSP1_BLSP_QUP2_QUP_MX_WRITE_CNT_CURRENT_ADDR A:0x78b7154
y.create.l HWIO_BLSP1_BLSP_QUP2_QUP_MX_INPUT_COUNT_ADDR A:0x78b7200
y.create.l HWIO_BLSP1_BLSP_QUP2_QUP_MX_INPUT_CNT_CURRENT_ADDR A:0x78b7204
y.create.l HWIO_BLSP1_BLSP_QUP2_QUP_MX_READ_COUNT_ADDR A:0x78b7208
y.create.l HWIO_BLSP1_BLSP_QUP2_QUP_MX_READ_CNT_CURRENT_ADDR A:0x78b720c
y.create.l HWIO_BLSP1_BLSP_QUP2_QUP_INPUT_DEBUG_ADDR A:0x78b7210
y.create.l HWIO_BLSP1_BLSP_QUP2_QUP_INPUT_FIFO_WORD_CNT_ADDR A:0x78b7214
y.create.l HWIO_BLSP1_BLSP_QUP2_QUP_INPUT_FIFO0_ADDR A:0x78b7218
y.create.l HWIO_BLSP1_BLSP_QUP2_QUP_INPUT_FIFO1_ADDR A:0x78b721c
y.create.l HWIO_BLSP1_BLSP_QUP2_QUP_INPUT_FIFO2_ADDR A:0x78b7220
y.create.l HWIO_BLSP1_BLSP_QUP2_QUP_INPUT_FIFO3_ADDR A:0x78b7224
y.create.l HWIO_BLSP1_BLSP_QUP2_QUP_INPUT_FIFO4_ADDR A:0x78b7228
y.create.l HWIO_BLSP1_BLSP_QUP2_QUP_INPUT_FIFO5_ADDR A:0x78b722c
y.create.l HWIO_BLSP1_BLSP_QUP2_QUP_INPUT_FIFO6_ADDR A:0x78b7230
y.create.l HWIO_BLSP1_BLSP_QUP2_QUP_INPUT_FIFO7_ADDR A:0x78b7234
y.create.l HWIO_BLSP1_BLSP_QUP2_QUP_INPUT_FIFO8_ADDR A:0x78b7238
y.create.l HWIO_BLSP1_BLSP_QUP2_QUP_INPUT_FIFO9_ADDR A:0x78b723c
y.create.l HWIO_BLSP1_BLSP_QUP2_SPI_CONFIG_ADDR A:0x78b7300
y.create.l HWIO_BLSP1_BLSP_QUP2_SPI_IO_CONTROL_ADDR A:0x78b7304
y.create.l HWIO_BLSP1_BLSP_QUP2_SPI_ERROR_FLAGS_ADDR A:0x78b7308
y.create.l HWIO_BLSP1_BLSP_QUP2_SPI_ERROR_FLAGS_EN_ADDR A:0x78b730c
y.create.l HWIO_BLSP1_BLSP_QUP2_SPI_DEASSERT_WAIT_ADDR A:0x78b7310
y.create.l HWIO_BLSP1_BLSP_QUP2_SPI_MASTER_LOCAL_ID_ADDR A:0x78b7314
y.create.l HWIO_BLSP1_BLSP_QUP2_SPI_MASTER_COMMAND_ADDR A:0x78b7318
y.create.l HWIO_BLSP1_BLSP_QUP2_SPI_MASTER_STATUS_ADDR A:0x78b731c
y.create.l HWIO_BLSP1_BLSP_QUP2_SPI_CHAR_CFG_ADDR A:0x78b7320
y.create.l HWIO_BLSP1_BLSP_QUP2_SPI_CHAR_DATA_SPI_CS_ADDR A:0x78b7324
y.create.l HWIO_BLSP1_BLSP_QUP2_SPI_CHAR_DATA_SPI_MOSI_ADDR A:0x78b7328
y.create.l HWIO_BLSP1_BLSP_QUP2_SPI_CHAR_DATA_SPI_MISO_ADDR A:0x78b732c
y.create.l HWIO_BLSP1_BLSP_QUP2_SPI_SLAVE_IRQ_STATUS_ADDR A:0x78b7330
y.create.l HWIO_BLSP1_BLSP_QUP2_SPI_SLAVE_IRQ_EN_ADDR A:0x78b7334
y.create.l HWIO_BLSP1_BLSP_QUP2_SPI_SLAVE_CFG_ADDR A:0x78b7338
y.create.l HWIO_BLSP1_BLSP_QUP2_SPI_SLAVE_DEBUG_ADDR A:0x78b733c
y.create.l HWIO_BLSP1_BLSP_QUP2_I2C_MASTER_CLK_CTL_ADDR A:0x78b7400
y.create.l HWIO_BLSP1_BLSP_QUP2_I2C_MASTER_STATUS_ADDR A:0x78b7404
y.create.l HWIO_BLSP1_BLSP_QUP2_I2C_MASTER_CONFIG_ADDR A:0x78b7408
y.create.l HWIO_BLSP1_BLSP_QUP2_I2C_MASTER_BUS_CLEAR_ADDR A:0x78b740c
y.create.l HWIO_BLSP1_BLSP_QUP2_I2C_MASTER_LOCAL_ID_ADDR A:0x78b7410
y.create.l HWIO_BLSP1_BLSP_QUP2_I2C_MASTER_COMMAND_ADDR A:0x78b7414
y.create.l HWIO_BLSP1_BLSP_QUP3_QUP_CONFIG_ADDR A:0x78b8000
y.create.l HWIO_BLSP1_BLSP_QUP3_QUP_STATE_ADDR A:0x78b8004
y.create.l HWIO_BLSP1_BLSP_QUP3_QUP_IO_MODES_ADDR A:0x78b8008
y.create.l HWIO_BLSP1_BLSP_QUP3_QUP_SW_RESET_ADDR A:0x78b800c
y.create.l HWIO_BLSP1_BLSP_QUP3_QUP_TRANSFER_CANCEL_ADDR A:0x78b8014
y.create.l HWIO_BLSP1_BLSP_QUP3_QUP_OPERATIONAL_ADDR A:0x78b8018
y.create.l HWIO_BLSP1_BLSP_QUP3_QUP_ERROR_FLAGS_ADDR A:0x78b801c
y.create.l HWIO_BLSP1_BLSP_QUP3_QUP_ERROR_FLAGS_EN_ADDR A:0x78b8020
y.create.l HWIO_BLSP1_BLSP_QUP3_QUP_TEST_CTRL_ADDR A:0x78b8024
y.create.l HWIO_BLSP1_BLSP_QUP3_QUP_OPERATIONAL_MASK_ADDR A:0x78b8028
y.create.l HWIO_BLSP1_BLSP_QUP3_QUP_HW_VERSION_ADDR A:0x78b8030
y.create.l HWIO_BLSP1_BLSP_QUP3_QUP_MX_OUTPUT_COUNT_ADDR A:0x78b8100
y.create.l HWIO_BLSP1_BLSP_QUP3_QUP_MX_OUTPUT_CNT_CURRENT_ADDR A:0x78b8104
y.create.l HWIO_BLSP1_BLSP_QUP3_QUP_OUTPUT_DEBUG_ADDR A:0x78b8108
y.create.l HWIO_BLSP1_BLSP_QUP3_QUP_OUTPUT_FIFO_WORD_CNT_ADDR A:0x78b810c
y.create.l HWIO_BLSP1_BLSP_QUP3_QUP_OUTPUT_FIFO0_ADDR A:0x78b8110
y.create.l HWIO_BLSP1_BLSP_QUP3_QUP_OUTPUT_FIFO1_ADDR A:0x78b8114
y.create.l HWIO_BLSP1_BLSP_QUP3_QUP_OUTPUT_FIFO2_ADDR A:0x78b8118
y.create.l HWIO_BLSP1_BLSP_QUP3_QUP_OUTPUT_FIFO3_ADDR A:0x78b811c
y.create.l HWIO_BLSP1_BLSP_QUP3_QUP_OUTPUT_FIFO4_ADDR A:0x78b8120
y.create.l HWIO_BLSP1_BLSP_QUP3_QUP_OUTPUT_FIFO5_ADDR A:0x78b8124
y.create.l HWIO_BLSP1_BLSP_QUP3_QUP_OUTPUT_FIFO6_ADDR A:0x78b8128
y.create.l HWIO_BLSP1_BLSP_QUP3_QUP_OUTPUT_FIFO7_ADDR A:0x78b812c
y.create.l HWIO_BLSP1_BLSP_QUP3_QUP_OUTPUT_FIFO8_ADDR A:0x78b8130
y.create.l HWIO_BLSP1_BLSP_QUP3_QUP_OUTPUT_FIFO9_ADDR A:0x78b8134
y.create.l HWIO_BLSP1_BLSP_QUP3_QUP_MX_WRITE_COUNT_ADDR A:0x78b8150
y.create.l HWIO_BLSP1_BLSP_QUP3_QUP_MX_WRITE_CNT_CURRENT_ADDR A:0x78b8154
y.create.l HWIO_BLSP1_BLSP_QUP3_QUP_MX_INPUT_COUNT_ADDR A:0x78b8200
y.create.l HWIO_BLSP1_BLSP_QUP3_QUP_MX_INPUT_CNT_CURRENT_ADDR A:0x78b8204
y.create.l HWIO_BLSP1_BLSP_QUP3_QUP_MX_READ_COUNT_ADDR A:0x78b8208
y.create.l HWIO_BLSP1_BLSP_QUP3_QUP_MX_READ_CNT_CURRENT_ADDR A:0x78b820c
y.create.l HWIO_BLSP1_BLSP_QUP3_QUP_INPUT_DEBUG_ADDR A:0x78b8210
y.create.l HWIO_BLSP1_BLSP_QUP3_QUP_INPUT_FIFO_WORD_CNT_ADDR A:0x78b8214
y.create.l HWIO_BLSP1_BLSP_QUP3_QUP_INPUT_FIFO0_ADDR A:0x78b8218
y.create.l HWIO_BLSP1_BLSP_QUP3_QUP_INPUT_FIFO1_ADDR A:0x78b821c
y.create.l HWIO_BLSP1_BLSP_QUP3_QUP_INPUT_FIFO2_ADDR A:0x78b8220
y.create.l HWIO_BLSP1_BLSP_QUP3_QUP_INPUT_FIFO3_ADDR A:0x78b8224
y.create.l HWIO_BLSP1_BLSP_QUP3_QUP_INPUT_FIFO4_ADDR A:0x78b8228
y.create.l HWIO_BLSP1_BLSP_QUP3_QUP_INPUT_FIFO5_ADDR A:0x78b822c
y.create.l HWIO_BLSP1_BLSP_QUP3_QUP_INPUT_FIFO6_ADDR A:0x78b8230
y.create.l HWIO_BLSP1_BLSP_QUP3_QUP_INPUT_FIFO7_ADDR A:0x78b8234
y.create.l HWIO_BLSP1_BLSP_QUP3_QUP_INPUT_FIFO8_ADDR A:0x78b8238
y.create.l HWIO_BLSP1_BLSP_QUP3_QUP_INPUT_FIFO9_ADDR A:0x78b823c
y.create.l HWIO_BLSP1_BLSP_QUP3_SPI_CONFIG_ADDR A:0x78b8300
y.create.l HWIO_BLSP1_BLSP_QUP3_SPI_IO_CONTROL_ADDR A:0x78b8304
y.create.l HWIO_BLSP1_BLSP_QUP3_SPI_ERROR_FLAGS_ADDR A:0x78b8308
y.create.l HWIO_BLSP1_BLSP_QUP3_SPI_ERROR_FLAGS_EN_ADDR A:0x78b830c
y.create.l HWIO_BLSP1_BLSP_QUP3_SPI_DEASSERT_WAIT_ADDR A:0x78b8310
y.create.l HWIO_BLSP1_BLSP_QUP3_SPI_MASTER_LOCAL_ID_ADDR A:0x78b8314
y.create.l HWIO_BLSP1_BLSP_QUP3_SPI_MASTER_COMMAND_ADDR A:0x78b8318
y.create.l HWIO_BLSP1_BLSP_QUP3_SPI_MASTER_STATUS_ADDR A:0x78b831c
y.create.l HWIO_BLSP1_BLSP_QUP3_SPI_CHAR_CFG_ADDR A:0x78b8320
y.create.l HWIO_BLSP1_BLSP_QUP3_SPI_CHAR_DATA_SPI_CS_ADDR A:0x78b8324
y.create.l HWIO_BLSP1_BLSP_QUP3_SPI_CHAR_DATA_SPI_MOSI_ADDR A:0x78b8328
y.create.l HWIO_BLSP1_BLSP_QUP3_SPI_CHAR_DATA_SPI_MISO_ADDR A:0x78b832c
y.create.l HWIO_BLSP1_BLSP_QUP3_SPI_SLAVE_IRQ_STATUS_ADDR A:0x78b8330
y.create.l HWIO_BLSP1_BLSP_QUP3_SPI_SLAVE_IRQ_EN_ADDR A:0x78b8334
y.create.l HWIO_BLSP1_BLSP_QUP3_SPI_SLAVE_CFG_ADDR A:0x78b8338
y.create.l HWIO_BLSP1_BLSP_QUP3_SPI_SLAVE_DEBUG_ADDR A:0x78b833c
y.create.l HWIO_BLSP1_BLSP_QUP3_I2C_MASTER_CLK_CTL_ADDR A:0x78b8400
y.create.l HWIO_BLSP1_BLSP_QUP3_I2C_MASTER_STATUS_ADDR A:0x78b8404
y.create.l HWIO_BLSP1_BLSP_QUP3_I2C_MASTER_CONFIG_ADDR A:0x78b8408
y.create.l HWIO_BLSP1_BLSP_QUP3_I2C_MASTER_BUS_CLEAR_ADDR A:0x78b840c
y.create.l HWIO_BLSP1_BLSP_QUP3_I2C_MASTER_LOCAL_ID_ADDR A:0x78b8410
y.create.l HWIO_BLSP1_BLSP_QUP3_I2C_MASTER_COMMAND_ADDR A:0x78b8414
y.create.l HWIO_BLSP1_BLSP_QUP4_QUP_CONFIG_ADDR A:0x78b9000
y.create.l HWIO_BLSP1_BLSP_QUP4_QUP_STATE_ADDR A:0x78b9004
y.create.l HWIO_BLSP1_BLSP_QUP4_QUP_IO_MODES_ADDR A:0x78b9008
y.create.l HWIO_BLSP1_BLSP_QUP4_QUP_SW_RESET_ADDR A:0x78b900c
y.create.l HWIO_BLSP1_BLSP_QUP4_QUP_TRANSFER_CANCEL_ADDR A:0x78b9014
y.create.l HWIO_BLSP1_BLSP_QUP4_QUP_OPERATIONAL_ADDR A:0x78b9018
y.create.l HWIO_BLSP1_BLSP_QUP4_QUP_ERROR_FLAGS_ADDR A:0x78b901c
y.create.l HWIO_BLSP1_BLSP_QUP4_QUP_ERROR_FLAGS_EN_ADDR A:0x78b9020
y.create.l HWIO_BLSP1_BLSP_QUP4_QUP_TEST_CTRL_ADDR A:0x78b9024
y.create.l HWIO_BLSP1_BLSP_QUP4_QUP_OPERATIONAL_MASK_ADDR A:0x78b9028
y.create.l HWIO_BLSP1_BLSP_QUP4_QUP_HW_VERSION_ADDR A:0x78b9030
y.create.l HWIO_BLSP1_BLSP_QUP4_QUP_MX_OUTPUT_COUNT_ADDR A:0x78b9100
y.create.l HWIO_BLSP1_BLSP_QUP4_QUP_MX_OUTPUT_CNT_CURRENT_ADDR A:0x78b9104
y.create.l HWIO_BLSP1_BLSP_QUP4_QUP_OUTPUT_DEBUG_ADDR A:0x78b9108
y.create.l HWIO_BLSP1_BLSP_QUP4_QUP_OUTPUT_FIFO_WORD_CNT_ADDR A:0x78b910c
y.create.l HWIO_BLSP1_BLSP_QUP4_QUP_OUTPUT_FIFO0_ADDR A:0x78b9110
y.create.l HWIO_BLSP1_BLSP_QUP4_QUP_OUTPUT_FIFO1_ADDR A:0x78b9114
y.create.l HWIO_BLSP1_BLSP_QUP4_QUP_OUTPUT_FIFO2_ADDR A:0x78b9118
y.create.l HWIO_BLSP1_BLSP_QUP4_QUP_OUTPUT_FIFO3_ADDR A:0x78b911c
y.create.l HWIO_BLSP1_BLSP_QUP4_QUP_OUTPUT_FIFO4_ADDR A:0x78b9120
y.create.l HWIO_BLSP1_BLSP_QUP4_QUP_OUTPUT_FIFO5_ADDR A:0x78b9124
y.create.l HWIO_BLSP1_BLSP_QUP4_QUP_OUTPUT_FIFO6_ADDR A:0x78b9128
y.create.l HWIO_BLSP1_BLSP_QUP4_QUP_OUTPUT_FIFO7_ADDR A:0x78b912c
y.create.l HWIO_BLSP1_BLSP_QUP4_QUP_OUTPUT_FIFO8_ADDR A:0x78b9130
y.create.l HWIO_BLSP1_BLSP_QUP4_QUP_OUTPUT_FIFO9_ADDR A:0x78b9134
y.create.l HWIO_BLSP1_BLSP_QUP4_QUP_MX_WRITE_COUNT_ADDR A:0x78b9150
y.create.l HWIO_BLSP1_BLSP_QUP4_QUP_MX_WRITE_CNT_CURRENT_ADDR A:0x78b9154
y.create.l HWIO_BLSP1_BLSP_QUP4_QUP_MX_INPUT_COUNT_ADDR A:0x78b9200
y.create.l HWIO_BLSP1_BLSP_QUP4_QUP_MX_INPUT_CNT_CURRENT_ADDR A:0x78b9204
y.create.l HWIO_BLSP1_BLSP_QUP4_QUP_MX_READ_COUNT_ADDR A:0x78b9208
y.create.l HWIO_BLSP1_BLSP_QUP4_QUP_MX_READ_CNT_CURRENT_ADDR A:0x78b920c
y.create.l HWIO_BLSP1_BLSP_QUP4_QUP_INPUT_DEBUG_ADDR A:0x78b9210
y.create.l HWIO_BLSP1_BLSP_QUP4_QUP_INPUT_FIFO_WORD_CNT_ADDR A:0x78b9214
y.create.l HWIO_BLSP1_BLSP_QUP4_QUP_INPUT_FIFO0_ADDR A:0x78b9218
y.create.l HWIO_BLSP1_BLSP_QUP4_QUP_INPUT_FIFO1_ADDR A:0x78b921c
y.create.l HWIO_BLSP1_BLSP_QUP4_QUP_INPUT_FIFO2_ADDR A:0x78b9220
y.create.l HWIO_BLSP1_BLSP_QUP4_QUP_INPUT_FIFO3_ADDR A:0x78b9224
y.create.l HWIO_BLSP1_BLSP_QUP4_QUP_INPUT_FIFO4_ADDR A:0x78b9228
y.create.l HWIO_BLSP1_BLSP_QUP4_QUP_INPUT_FIFO5_ADDR A:0x78b922c
y.create.l HWIO_BLSP1_BLSP_QUP4_QUP_INPUT_FIFO6_ADDR A:0x78b9230
y.create.l HWIO_BLSP1_BLSP_QUP4_QUP_INPUT_FIFO7_ADDR A:0x78b9234
y.create.l HWIO_BLSP1_BLSP_QUP4_QUP_INPUT_FIFO8_ADDR A:0x78b9238
y.create.l HWIO_BLSP1_BLSP_QUP4_QUP_INPUT_FIFO9_ADDR A:0x78b923c
y.create.l HWIO_BLSP1_BLSP_QUP4_SPI_CONFIG_ADDR A:0x78b9300
y.create.l HWIO_BLSP1_BLSP_QUP4_SPI_IO_CONTROL_ADDR A:0x78b9304
y.create.l HWIO_BLSP1_BLSP_QUP4_SPI_ERROR_FLAGS_ADDR A:0x78b9308
y.create.l HWIO_BLSP1_BLSP_QUP4_SPI_ERROR_FLAGS_EN_ADDR A:0x78b930c
y.create.l HWIO_BLSP1_BLSP_QUP4_SPI_DEASSERT_WAIT_ADDR A:0x78b9310
y.create.l HWIO_BLSP1_BLSP_QUP4_SPI_MASTER_LOCAL_ID_ADDR A:0x78b9314
y.create.l HWIO_BLSP1_BLSP_QUP4_SPI_MASTER_COMMAND_ADDR A:0x78b9318
y.create.l HWIO_BLSP1_BLSP_QUP4_SPI_MASTER_STATUS_ADDR A:0x78b931c
y.create.l HWIO_BLSP1_BLSP_QUP4_SPI_CHAR_CFG_ADDR A:0x78b9320
y.create.l HWIO_BLSP1_BLSP_QUP4_SPI_CHAR_DATA_SPI_CS_ADDR A:0x78b9324
y.create.l HWIO_BLSP1_BLSP_QUP4_SPI_CHAR_DATA_SPI_MOSI_ADDR A:0x78b9328
y.create.l HWIO_BLSP1_BLSP_QUP4_SPI_CHAR_DATA_SPI_MISO_ADDR A:0x78b932c
y.create.l HWIO_BLSP1_BLSP_QUP4_SPI_SLAVE_IRQ_STATUS_ADDR A:0x78b9330
y.create.l HWIO_BLSP1_BLSP_QUP4_SPI_SLAVE_IRQ_EN_ADDR A:0x78b9334
y.create.l HWIO_BLSP1_BLSP_QUP4_SPI_SLAVE_CFG_ADDR A:0x78b9338
y.create.l HWIO_BLSP1_BLSP_QUP4_SPI_SLAVE_DEBUG_ADDR A:0x78b933c
y.create.l HWIO_BLSP1_BLSP_QUP4_I2C_MASTER_CLK_CTL_ADDR A:0x78b9400
y.create.l HWIO_BLSP1_BLSP_QUP4_I2C_MASTER_STATUS_ADDR A:0x78b9404
y.create.l HWIO_BLSP1_BLSP_QUP4_I2C_MASTER_CONFIG_ADDR A:0x78b9408
y.create.l HWIO_BLSP1_BLSP_QUP4_I2C_MASTER_BUS_CLEAR_ADDR A:0x78b940c
y.create.l HWIO_BLSP1_BLSP_QUP4_I2C_MASTER_LOCAL_ID_ADDR A:0x78b9410
y.create.l HWIO_BLSP1_BLSP_QUP4_I2C_MASTER_COMMAND_ADDR A:0x78b9414
y.create.l HWIO_BLSP1_BLSP_QUP5_QUP_CONFIG_ADDR A:0x78ba000
y.create.l HWIO_BLSP1_BLSP_QUP5_QUP_STATE_ADDR A:0x78ba004
y.create.l HWIO_BLSP1_BLSP_QUP5_QUP_IO_MODES_ADDR A:0x78ba008
y.create.l HWIO_BLSP1_BLSP_QUP5_QUP_SW_RESET_ADDR A:0x78ba00c
y.create.l HWIO_BLSP1_BLSP_QUP5_QUP_TRANSFER_CANCEL_ADDR A:0x78ba014
y.create.l HWIO_BLSP1_BLSP_QUP5_QUP_OPERATIONAL_ADDR A:0x78ba018
y.create.l HWIO_BLSP1_BLSP_QUP5_QUP_ERROR_FLAGS_ADDR A:0x78ba01c
y.create.l HWIO_BLSP1_BLSP_QUP5_QUP_ERROR_FLAGS_EN_ADDR A:0x78ba020
y.create.l HWIO_BLSP1_BLSP_QUP5_QUP_TEST_CTRL_ADDR A:0x78ba024
y.create.l HWIO_BLSP1_BLSP_QUP5_QUP_OPERATIONAL_MASK_ADDR A:0x78ba028
y.create.l HWIO_BLSP1_BLSP_QUP5_QUP_HW_VERSION_ADDR A:0x78ba030
y.create.l HWIO_BLSP1_BLSP_QUP5_QUP_MX_OUTPUT_COUNT_ADDR A:0x78ba100
y.create.l HWIO_BLSP1_BLSP_QUP5_QUP_MX_OUTPUT_CNT_CURRENT_ADDR A:0x78ba104
y.create.l HWIO_BLSP1_BLSP_QUP5_QUP_OUTPUT_DEBUG_ADDR A:0x78ba108
y.create.l HWIO_BLSP1_BLSP_QUP5_QUP_OUTPUT_FIFO_WORD_CNT_ADDR A:0x78ba10c
y.create.l HWIO_BLSP1_BLSP_QUP5_QUP_OUTPUT_FIFO0_ADDR A:0x78ba110
y.create.l HWIO_BLSP1_BLSP_QUP5_QUP_OUTPUT_FIFO1_ADDR A:0x78ba114
y.create.l HWIO_BLSP1_BLSP_QUP5_QUP_OUTPUT_FIFO2_ADDR A:0x78ba118
y.create.l HWIO_BLSP1_BLSP_QUP5_QUP_OUTPUT_FIFO3_ADDR A:0x78ba11c
y.create.l HWIO_BLSP1_BLSP_QUP5_QUP_OUTPUT_FIFO4_ADDR A:0x78ba120
y.create.l HWIO_BLSP1_BLSP_QUP5_QUP_OUTPUT_FIFO5_ADDR A:0x78ba124
y.create.l HWIO_BLSP1_BLSP_QUP5_QUP_OUTPUT_FIFO6_ADDR A:0x78ba128
y.create.l HWIO_BLSP1_BLSP_QUP5_QUP_OUTPUT_FIFO7_ADDR A:0x78ba12c
y.create.l HWIO_BLSP1_BLSP_QUP5_QUP_OUTPUT_FIFO8_ADDR A:0x78ba130
y.create.l HWIO_BLSP1_BLSP_QUP5_QUP_OUTPUT_FIFO9_ADDR A:0x78ba134
y.create.l HWIO_BLSP1_BLSP_QUP5_QUP_MX_WRITE_COUNT_ADDR A:0x78ba150
y.create.l HWIO_BLSP1_BLSP_QUP5_QUP_MX_WRITE_CNT_CURRENT_ADDR A:0x78ba154
y.create.l HWIO_BLSP1_BLSP_QUP5_QUP_MX_INPUT_COUNT_ADDR A:0x78ba200
y.create.l HWIO_BLSP1_BLSP_QUP5_QUP_MX_INPUT_CNT_CURRENT_ADDR A:0x78ba204
y.create.l HWIO_BLSP1_BLSP_QUP5_QUP_MX_READ_COUNT_ADDR A:0x78ba208
y.create.l HWIO_BLSP1_BLSP_QUP5_QUP_MX_READ_CNT_CURRENT_ADDR A:0x78ba20c
y.create.l HWIO_BLSP1_BLSP_QUP5_QUP_INPUT_DEBUG_ADDR A:0x78ba210
y.create.l HWIO_BLSP1_BLSP_QUP5_QUP_INPUT_FIFO_WORD_CNT_ADDR A:0x78ba214
y.create.l HWIO_BLSP1_BLSP_QUP5_QUP_INPUT_FIFO0_ADDR A:0x78ba218
y.create.l HWIO_BLSP1_BLSP_QUP5_QUP_INPUT_FIFO1_ADDR A:0x78ba21c
y.create.l HWIO_BLSP1_BLSP_QUP5_QUP_INPUT_FIFO2_ADDR A:0x78ba220
y.create.l HWIO_BLSP1_BLSP_QUP5_QUP_INPUT_FIFO3_ADDR A:0x78ba224
y.create.l HWIO_BLSP1_BLSP_QUP5_QUP_INPUT_FIFO4_ADDR A:0x78ba228
y.create.l HWIO_BLSP1_BLSP_QUP5_QUP_INPUT_FIFO5_ADDR A:0x78ba22c
y.create.l HWIO_BLSP1_BLSP_QUP5_QUP_INPUT_FIFO6_ADDR A:0x78ba230
y.create.l HWIO_BLSP1_BLSP_QUP5_QUP_INPUT_FIFO7_ADDR A:0x78ba234
y.create.l HWIO_BLSP1_BLSP_QUP5_QUP_INPUT_FIFO8_ADDR A:0x78ba238
y.create.l HWIO_BLSP1_BLSP_QUP5_QUP_INPUT_FIFO9_ADDR A:0x78ba23c
y.create.l HWIO_BLSP1_BLSP_QUP5_SPI_CONFIG_ADDR A:0x78ba300
y.create.l HWIO_BLSP1_BLSP_QUP5_SPI_IO_CONTROL_ADDR A:0x78ba304
y.create.l HWIO_BLSP1_BLSP_QUP5_SPI_ERROR_FLAGS_ADDR A:0x78ba308
y.create.l HWIO_BLSP1_BLSP_QUP5_SPI_ERROR_FLAGS_EN_ADDR A:0x78ba30c
y.create.l HWIO_BLSP1_BLSP_QUP5_SPI_DEASSERT_WAIT_ADDR A:0x78ba310
y.create.l HWIO_BLSP1_BLSP_QUP5_SPI_MASTER_LOCAL_ID_ADDR A:0x78ba314
y.create.l HWIO_BLSP1_BLSP_QUP5_SPI_MASTER_COMMAND_ADDR A:0x78ba318
y.create.l HWIO_BLSP1_BLSP_QUP5_SPI_MASTER_STATUS_ADDR A:0x78ba31c
y.create.l HWIO_BLSP1_BLSP_QUP5_SPI_CHAR_CFG_ADDR A:0x78ba320
y.create.l HWIO_BLSP1_BLSP_QUP5_SPI_CHAR_DATA_SPI_CS_ADDR A:0x78ba324
y.create.l HWIO_BLSP1_BLSP_QUP5_SPI_CHAR_DATA_SPI_MOSI_ADDR A:0x78ba328
y.create.l HWIO_BLSP1_BLSP_QUP5_SPI_CHAR_DATA_SPI_MISO_ADDR A:0x78ba32c
y.create.l HWIO_BLSP1_BLSP_QUP5_SPI_SLAVE_IRQ_STATUS_ADDR A:0x78ba330
y.create.l HWIO_BLSP1_BLSP_QUP5_SPI_SLAVE_IRQ_EN_ADDR A:0x78ba334
y.create.l HWIO_BLSP1_BLSP_QUP5_SPI_SLAVE_CFG_ADDR A:0x78ba338
y.create.l HWIO_BLSP1_BLSP_QUP5_SPI_SLAVE_DEBUG_ADDR A:0x78ba33c
y.create.l HWIO_BLSP1_BLSP_QUP5_I2C_MASTER_CLK_CTL_ADDR A:0x78ba400
y.create.l HWIO_BLSP1_BLSP_QUP5_I2C_MASTER_STATUS_ADDR A:0x78ba404
y.create.l HWIO_BLSP1_BLSP_QUP5_I2C_MASTER_CONFIG_ADDR A:0x78ba408
y.create.l HWIO_BLSP1_BLSP_QUP5_I2C_MASTER_BUS_CLEAR_ADDR A:0x78ba40c
y.create.l HWIO_BLSP1_BLSP_QUP5_I2C_MASTER_LOCAL_ID_ADDR A:0x78ba410
y.create.l HWIO_BLSP1_BLSP_QUP5_I2C_MASTER_COMMAND_ADDR A:0x78ba414
y.create.l HWIO_BOOT_ROM_XPU_SCR_ADDR A:0x1ff000
y.create.l HWIO_BOOT_ROM_XPU_SWDR_ADDR A:0x1ff004
y.create.l HWIO_BOOT_ROM_XPU_PRTN_RACR_SSHADOW_ADDR A:0x1ff008
y.create.l HWIO_BOOT_ROM_XPU_PRTN_START_SSHADOW0_ADDR A:0x1ff010
y.create.l HWIO_BOOT_ROM_XPU_PRTN_END_SSHADOW0_ADDR A:0x1ff018
y.create.l HWIO_BOOT_ROM_XPU_SEAR0_ADDR A:0x1ff040
y.create.l HWIO_BOOT_ROM_XPU_SESR_ADDR A:0x1ff048
y.create.l HWIO_BOOT_ROM_XPU_SESRRESTORE_ADDR A:0x1ff04c
y.create.l HWIO_BOOT_ROM_XPU_SESYNR0_ADDR A:0x1ff050
y.create.l HWIO_BOOT_ROM_XPU_SESYNR1_ADDR A:0x1ff054
y.create.l HWIO_BOOT_ROM_XPU_SESYNR2_ADDR A:0x1ff058
y.create.l HWIO_BOOT_ROM_XPU_MCR_ADDR A:0x1ff100
y.create.l HWIO_BOOT_ROM_XPU_MEAR0_ADDR A:0x1ff140
y.create.l HWIO_BOOT_ROM_XPU_MESR_ADDR A:0x1ff148
y.create.l HWIO_BOOT_ROM_XPU_MESRRESTORE_ADDR A:0x1ff14c
y.create.l HWIO_BOOT_ROM_XPU_MESYNR0_ADDR A:0x1ff150
y.create.l HWIO_BOOT_ROM_XPU_MESYNR1_ADDR A:0x1ff154
y.create.l HWIO_BOOT_ROM_XPU_MESYNR2_ADDR A:0x1ff158
y.create.l HWIO_BOOT_ROM_XPU_CR_ADDR A:0x1ff080
y.create.l HWIO_BOOT_ROM_XPU_PRTN_RACR_SHADOW_ADDR A:0x1ff088
y.create.l HWIO_BOOT_ROM_XPU_PRTN_START_SHADOW0_ADDR A:0x1ff090
y.create.l HWIO_BOOT_ROM_XPU_PRTN_END_SHADOW0_ADDR A:0x1ff098
y.create.l HWIO_BOOT_ROM_XPU_RPU_ACR0_ADDR A:0x1ff0a0
y.create.l HWIO_BOOT_ROM_XPU_EAR0_ADDR A:0x1ff0c0
y.create.l HWIO_BOOT_ROM_XPU_ESR_ADDR A:0x1ff0c8
y.create.l HWIO_BOOT_ROM_XPU_ESRRESTORE_ADDR A:0x1ff0cc
y.create.l HWIO_BOOT_ROM_XPU_ESYNR0_ADDR A:0x1ff0d0
y.create.l HWIO_BOOT_ROM_XPU_ESYNR1_ADDR A:0x1ff0d4
y.create.l HWIO_BOOT_ROM_XPU_ESYNR2_ADDR A:0x1ff0d8
y.create.l HWIO_BOOT_ROM_XPU_UMR_RACR_ADDR A:0x1ff0e0
y.create.l HWIO_BOOT_ROM_XPU_UMR_WACR_ADDR A:0x1ff0e4
y.create.l HWIO_BOOT_ROM_XPU_UMR_CNTL_ADDR A:0x1ff0f0
y.create.l HWIO_BOOT_ROM_XPU_IDR0_ADDR A:0x1ff074
y.create.l HWIO_BOOT_ROM_XPU_IDR1_ADDR A:0x1ff078
y.create.l HWIO_BOOT_ROM_XPU_REV_ADDR A:0x1ff07c
y.create.l HWIO_BOOT_ROM_XPU_PRT0_RACR0_ADDR A:0x1ff200
y.create.l HWIO_BOOT_ROM_XPU_PRT1_RACR0_ADDR A:0x1ff280
y.create.l HWIO_BOOT_ROM_XPU_PRT2_RACR0_ADDR A:0x1ff300
y.create.l HWIO_BOOT_ROM_XPU_PRT0_START0_ADDR A:0x1ff240
y.create.l HWIO_BOOT_ROM_XPU_PRT1_START0_ADDR A:0x1ff2c0
y.create.l HWIO_BOOT_ROM_XPU_PRT2_START0_ADDR A:0x1ff340
y.create.l HWIO_BOOT_ROM_XPU_PRT0_END0_ADDR A:0x1ff248
y.create.l HWIO_BOOT_ROM_XPU_PRT1_END0_ADDR A:0x1ff2c8
y.create.l HWIO_BOOT_ROM_XPU_PRT2_END0_ADDR A:0x1ff348
y.create.l HWIO_BOOT_ROM_XPU_PRT0_SCR_ADDR A:0x1ff250
y.create.l HWIO_BOOT_ROM_XPU_PRT1_SCR_ADDR A:0x1ff2d0
y.create.l HWIO_BOOT_ROM_XPU_PRT2_SCR_ADDR A:0x1ff350
y.create.l HWIO_BOOT_ROM_XPU_PRT0_MCR_ADDR A:0x1ff254
y.create.l HWIO_BOOT_ROM_XPU_PRT1_MCR_ADDR A:0x1ff2d4
y.create.l HWIO_BOOT_ROM_XPU_PRT2_MCR_ADDR A:0x1ff354
y.create.l HWIO_BOOT_ROM_XPU_PRT0_CNTL0_ADDR A:0x1ff258
y.create.l HWIO_BOOT_ROM_XPU_PRT1_CNTL0_ADDR A:0x1ff2d8
y.create.l HWIO_BOOT_ROM_XPU_PRT2_CNTL0_ADDR A:0x1ff358
y.create.l HWIO_BOOT_ROM_XPU_PRT0_CNTL1_ADDR A:0x1ff25c
y.create.l HWIO_BOOT_ROM_XPU_PRT1_CNTL1_ADDR A:0x1ff2dc
y.create.l HWIO_BOOT_ROM_XPU_PRT2_CNTL1_ADDR A:0x1ff35c
y.create.l HWIO_GCC_GPLL0_MODE_ADDR A:0x1821000
y.create.l HWIO_GCC_GPLL0_L_VAL_ADDR A:0x1821004
y.create.l HWIO_GCC_GPLL0_ALPHA_VAL_ADDR A:0x1821008
y.create.l HWIO_GCC_GPLL0_ALPHA_VAL_U_ADDR A:0x182100c
y.create.l HWIO_GCC_GPLL0_USER_CTL_ADDR A:0x1821010
y.create.l HWIO_GCC_GPLL0_USER_CTL_U_ADDR A:0x1821014
y.create.l HWIO_GCC_GPLL0_CONFIG_CTL_ADDR A:0x1821018
y.create.l HWIO_GCC_GPLL0_TEST_CTL_ADDR A:0x182101c
y.create.l HWIO_GCC_GPLL0_TEST_CTL_U_ADDR A:0x1821020
y.create.l HWIO_GCC_GPLL0_STATUS_ADDR A:0x1821024
y.create.l HWIO_GCC_GPLL0_FREQ_CTL_ADDR A:0x1821028
y.create.l HWIO_GCC_GPLL0_SSC_UPDATE_RATE_ADDR A:0x182102c
y.create.l HWIO_GCC_GPLL0_SSC_DELTA_ALPHA_ADDR A:0x1821030
y.create.l HWIO_GCC_GPLL0_SSC_NUM_STEPS_ADDR A:0x1821034
y.create.l HWIO_GCC_GPLL1_MODE_ADDR A:0x1820000
y.create.l HWIO_GCC_GPLL1_L_VAL_ADDR A:0x1820004
y.create.l HWIO_GCC_GPLL1_M_VAL_ADDR A:0x1820008
y.create.l HWIO_GCC_GPLL1_N_VAL_ADDR A:0x182000c
y.create.l HWIO_GCC_GPLL1_USER_CTL_ADDR A:0x1820010
y.create.l HWIO_GCC_GPLL1_CONFIG_CTL_ADDR A:0x1820014
y.create.l HWIO_GCC_GPLL1_TEST_CTL_ADDR A:0x1820018
y.create.l HWIO_GCC_GPLL1_STATUS_ADDR A:0x182001c
y.create.l HWIO_GCC_GPLL2_MODE_ADDR A:0x1825000
y.create.l HWIO_GCC_GPLL2_L_VAL_ADDR A:0x1825004
y.create.l HWIO_GCC_GPLL2_ALPHA_VAL_ADDR A:0x1825008
y.create.l HWIO_GCC_GPLL2_ALPHA_VAL_U_ADDR A:0x182500c
y.create.l HWIO_GCC_GPLL2_USER_CTL_ADDR A:0x1825010
y.create.l HWIO_GCC_GPLL2_USER_CTL_U_ADDR A:0x1825014
y.create.l HWIO_GCC_GPLL2_CONFIG_CTL_ADDR A:0x1825018
y.create.l HWIO_GCC_GPLL2_TEST_CTL_ADDR A:0x182501c
y.create.l HWIO_GCC_GPLL2_TEST_CTL_U_ADDR A:0x1825020
y.create.l HWIO_GCC_GPLL2_STATUS_ADDR A:0x1825024
y.create.l HWIO_GCC_GPLL2_FREQ_CTL_ADDR A:0x1825028
y.create.l HWIO_GCC_GPLL2_SSC_UPDATE_RATE_ADDR A:0x182502c
y.create.l HWIO_GCC_GPLL2_SSC_DELTA_ALPHA_ADDR A:0x1825030
y.create.l HWIO_GCC_GPLL2_SSC_NUM_STEPS_ADDR A:0x1825034
y.create.l HWIO_GCC_BIMC_PLL_MODE_ADDR A:0x1823000
y.create.l HWIO_GCC_BIMC_PLL_L_VAL_ADDR A:0x1823004
y.create.l HWIO_GCC_BIMC_PLL_ALPHA_VAL_ADDR A:0x1823008
y.create.l HWIO_GCC_BIMC_PLL_ALPHA_VAL_U_ADDR A:0x182300c
y.create.l HWIO_GCC_BIMC_PLL_USER_CTL_ADDR A:0x1823010
y.create.l HWIO_GCC_BIMC_PLL_USER_CTL_U_ADDR A:0x1823014
y.create.l HWIO_GCC_BIMC_PLL_CONFIG_CTL_ADDR A:0x1823018
y.create.l HWIO_GCC_BIMC_PLL_TEST_CTL_ADDR A:0x182301c
y.create.l HWIO_GCC_BIMC_PLL_TEST_CTL_U_ADDR A:0x1823020
y.create.l HWIO_GCC_BIMC_PLL_STATUS_ADDR A:0x1823024
y.create.l HWIO_GCC_BIMC_PLL_FREQ_CTL_ADDR A:0x1823028
y.create.l HWIO_GCC_BIMC_PLL_SSC_UPDATE_RATE_ADDR A:0x182302c
y.create.l HWIO_GCC_BIMC_PLL_SSC_DELTA_ALPHA_ADDR A:0x1823030
y.create.l HWIO_GCC_BIMC_PLL_SSC_NUM_STEPS_ADDR A:0x1823034
y.create.l HWIO_GCC_PCNOC_BFDCD_CMD_RCGR_ADDR A:0x1827000
y.create.l HWIO_GCC_PCNOC_BFDCD_CFG_RCGR_ADDR A:0x1827004
y.create.l HWIO_GCC_PCNOC_BCR_ADDR A:0x1827018
y.create.l HWIO_GCC_PCNOC_AHB_CBCR_ADDR A:0x182701c
y.create.l HWIO_GCC_PCNOC_DDR_CFG_CBCR_ADDR A:0x1832024
y.create.l HWIO_GCC_PCNOC_RPM_AHB_CBCR_ADDR A:0x1827024
y.create.l HWIO_GCC_PCNOC_AT_CBCR_ADDR A:0x1827028
y.create.l HWIO_GCC_PCNOC_QDSS_STM_AXI_CBCR_ADDR A:0x182702c
y.create.l HWIO_GCC_PCNOC_APSS_AHB_CBCR_ADDR A:0x1827030
y.create.l HWIO_GCC_NOC_CONF_XPU_AHB_CBCR_ADDR A:0x1817000
y.create.l HWIO_GCC_IMEM_BCR_ADDR A:0x180e000
y.create.l HWIO_GCC_IMEM_AXI_CBCR_ADDR A:0x180e004
y.create.l HWIO_GCC_IMEM_CFG_AHB_CBCR_ADDR A:0x180e008
y.create.l HWIO_GCC_MSS_CFG_AHB_CBCR_ADDR A:0x1849000
y.create.l HWIO_GCC_MSS_Q6_BIMC_AXI_CBCR_ADDR A:0x1849004
y.create.l HWIO_GCC_RPM_CFG_XPU_CBCR_ADDR A:0x1817004
y.create.l HWIO_GCC_QDSS_BCR_ADDR A:0x1829000
y.create.l HWIO_GCC_QDSS_DAP_AHB_CBCR_ADDR A:0x1829004
y.create.l HWIO_GCC_QDSS_CFG_AHB_CBCR_ADDR A:0x1829008
y.create.l HWIO_GCC_QDSS_AT_CMD_RCGR_ADDR A:0x182900c
y.create.l HWIO_GCC_QDSS_AT_CFG_RCGR_ADDR A:0x1829010
y.create.l HWIO_GCC_QDSS_AT_CBCR_ADDR A:0x1829024
y.create.l HWIO_GCC_QDSS_ETR_USB_CBCR_ADDR A:0x1829028
y.create.l HWIO_GCC_QDSS_STM_CMD_RCGR_ADDR A:0x182902c
y.create.l HWIO_GCC_QDSS_STM_CFG_RCGR_ADDR A:0x1829030
y.create.l HWIO_GCC_QDSS_STM_CBCR_ADDR A:0x1829044
y.create.l HWIO_GCC_QDSS_TRACECLKIN_CMD_RCGR_ADDR A:0x1829048
y.create.l HWIO_GCC_QDSS_TRACECLKIN_CFG_RCGR_ADDR A:0x182904c
y.create.l HWIO_GCC_QDSS_TRACECLKIN_CBCR_ADDR A:0x1829060
y.create.l HWIO_GCC_QDSS_TSCTR_CMD_RCGR_ADDR A:0x1829064
y.create.l HWIO_GCC_QDSS_TSCTR_CFG_RCGR_ADDR A:0x1829068
y.create.l HWIO_GCC_QDSS_TSCTR_DIV2_CBCR_ADDR A:0x182907c
y.create.l HWIO_GCC_QDSS_TSCTR_DIV3_CBCR_ADDR A:0x1829080
y.create.l HWIO_GCC_QDSS_DAP_CBCR_ADDR A:0x1829084
y.create.l HWIO_GCC_QDSS_TSCTR_DIV4_CBCR_ADDR A:0x1829088
y.create.l HWIO_GCC_QDSS_TSCTR_DIV8_CBCR_ADDR A:0x182908c
y.create.l HWIO_GCC_QDSS_TSCTR_DIV16_CBCR_ADDR A:0x1829090
y.create.l HWIO_GCC_QPIC_BCR_ADDR A:0x183f000
y.create.l HWIO_GCC_QPIC_CMD_RCGR_ADDR A:0x183f004
y.create.l HWIO_GCC_QPIC_CFG_RCGR_ADDR A:0x183f008
y.create.l HWIO_GCC_QPIC_M_ADDR A:0x183f00c
y.create.l HWIO_GCC_QPIC_N_ADDR A:0x183f010
y.create.l HWIO_GCC_QPIC_D_ADDR A:0x183f014
y.create.l HWIO_GCC_QPIC_CBCR_ADDR A:0x183f018
y.create.l HWIO_GCC_QPIC_AHB_CBCR_ADDR A:0x183f01c
y.create.l HWIO_GCC_QPIC_SYSTEM_CBCR_ADDR A:0x183f020
y.create.l HWIO_GCC_GCC_SLEEP_CMD_RCGR_ADDR A:0x1830000
y.create.l HWIO_GCC_USB_HS_BCR_ADDR A:0x1841000
y.create.l HWIO_GCC_USB_HS_SYSTEM_CBCR_ADDR A:0x1841004
y.create.l HWIO_GCC_USB_HS_AHB_CBCR_ADDR A:0x1841008
y.create.l HWIO_GCC_USB_HS_PHY_CFG_AHB_CBCR_ADDR A:0x1841030
y.create.l HWIO_GCC_USB_HS_INACTIVITY_TIMERS_CBCR_ADDR A:0x184100c
y.create.l HWIO_GCC_USB_HSIC_SYSTEM_CBCR_ADDR A:0x183d048
y.create.l HWIO_GCC_USB_HSIC_AHB_CBCR_ADDR A:0x183d04c
y.create.l HWIO_GCC_USB_HSIC_CBCR_ADDR A:0x183d050
y.create.l HWIO_GCC_USB_HSIC_IO_CAL_CBCR_ADDR A:0x183d054
y.create.l HWIO_GCC_USB_HSIC_IO_CAL_SLEEP_CBCR_ADDR A:0x183d058
y.create.l HWIO_GCC_BIMC_MCDMA_AXI_CBCR_ADDR A:0x1831048
y.create.l HWIO_GCC_BIMC_NAV_AXI_CBCR_ADDR A:0x183104c
y.create.l HWIO_GCC_USB_HS_SYSTEM_CMD_RCGR_ADDR A:0x1841010
y.create.l HWIO_GCC_USB_HS_SYSTEM_CFG_RCGR_ADDR A:0x1841014
y.create.l HWIO_GCC_USB_HSIC_SYSTEM_CMD_RCGR_ADDR A:0x183d000
y.create.l HWIO_GCC_USB_HSIC_SYSTEM_CFG_RCGR_ADDR A:0x183d004
y.create.l HWIO_GCC_USB_HSIC_CMD_RCGR_ADDR A:0x183d018
y.create.l HWIO_GCC_USB_HSIC_CFG_RCGR_ADDR A:0x183d01c
y.create.l HWIO_GCC_USB_HSIC_IO_CAL_CMD_RCGR_ADDR A:0x183d030
y.create.l HWIO_GCC_USB_HSIC_IO_CAL_CFG_RCGR_ADDR A:0x183d034
y.create.l HWIO_GCC_USB_HS_HSIC_BCR_ADDR A:0x183d05c
y.create.l HWIO_GCC_USB2A_PHY_BCR_ADDR A:0x1841028
y.create.l HWIO_GCC_USB2_HS_PHY_ONLY_BCR_ADDR A:0x1841034
y.create.l HWIO_GCC_USB_HS_PHY_CFG_AHB_BCR_ADDR A:0x1841038
y.create.l HWIO_GCC_QUSB2_PHY_BCR_ADDR A:0x184103c
y.create.l HWIO_GCC_USB2A_PHY_SLEEP_CBCR_ADDR A:0x184102c
y.create.l HWIO_GCC_SDCC1_BCR_ADDR A:0x1842000
y.create.l HWIO_GCC_SDCC1_APPS_CMD_RCGR_ADDR A:0x1842004
y.create.l HWIO_GCC_SDCC1_APPS_CFG_RCGR_ADDR A:0x1842008
y.create.l HWIO_GCC_SDCC1_APPS_M_ADDR A:0x184200c
y.create.l HWIO_GCC_SDCC1_APPS_N_ADDR A:0x1842010
y.create.l HWIO_GCC_SDCC1_APPS_D_ADDR A:0x1842014
y.create.l HWIO_GCC_SDCC1_APPS_CBCR_ADDR A:0x1842018
y.create.l HWIO_GCC_SDCC1_AHB_CBCR_ADDR A:0x184201c
y.create.l HWIO_GCC_SDCC1_MISC_ADDR A:0x1842020
y.create.l HWIO_GCC_SDCC2_BCR_ADDR A:0x1843000
y.create.l HWIO_GCC_SDCC2_APPS_CMD_RCGR_ADDR A:0x1843004
y.create.l HWIO_GCC_SDCC2_APPS_CFG_RCGR_ADDR A:0x1843008
y.create.l HWIO_GCC_SDCC2_APPS_M_ADDR A:0x184300c
y.create.l HWIO_GCC_SDCC2_APPS_N_ADDR A:0x1843010
y.create.l HWIO_GCC_SDCC2_APPS_D_ADDR A:0x1843014
y.create.l HWIO_GCC_SDCC2_APPS_CBCR_ADDR A:0x1843018
y.create.l HWIO_GCC_SDCC2_AHB_CBCR_ADDR A:0x184301c
y.create.l HWIO_GCC_BLSP1_BCR_ADDR A:0x1801000
y.create.l HWIO_GCC_BLSP1_SLEEP_CBCR_ADDR A:0x1801004
y.create.l HWIO_GCC_BLSP1_AHB_CBCR_ADDR A:0x1801008
y.create.l HWIO_GCC_BLSP1_QUP1_BCR_ADDR A:0x1802000
y.create.l HWIO_GCC_BLSP1_QUP1_SPI_APPS_CBCR_ADDR A:0x1802004
y.create.l HWIO_GCC_BLSP1_QUP1_I2C_APPS_CBCR_ADDR A:0x1802008
y.create.l HWIO_GCC_BLSP1_QUP1_I2C_APPS_CMD_RCGR_ADDR A:0x180200c
y.create.l HWIO_GCC_BLSP1_QUP1_I2C_APPS_CFG_RCGR_ADDR A:0x1802010
y.create.l HWIO_GCC_BLSP1_QUP2_I2C_APPS_CMD_RCGR_ADDR A:0x1803000
y.create.l HWIO_GCC_BLSP1_QUP2_I2C_APPS_CFG_RCGR_ADDR A:0x1803004
y.create.l HWIO_GCC_BLSP1_QUP3_I2C_APPS_CMD_RCGR_ADDR A:0x1804000
y.create.l HWIO_GCC_BLSP1_QUP3_I2C_APPS_CFG_RCGR_ADDR A:0x1804004
y.create.l HWIO_GCC_BLSP1_QUP4_I2C_APPS_CMD_RCGR_ADDR A:0x1805000
y.create.l HWIO_GCC_BLSP1_QUP4_I2C_APPS_CFG_RCGR_ADDR A:0x1805004
y.create.l HWIO_GCC_BLSP1_QUP5_I2C_APPS_CMD_RCGR_ADDR A:0x1806000
y.create.l HWIO_GCC_BLSP1_QUP5_I2C_APPS_CFG_RCGR_ADDR A:0x1806004
y.create.l HWIO_GCC_BLSP1_QUP6_I2C_APPS_CMD_RCGR_ADDR A:0x1807000
y.create.l HWIO_GCC_BLSP1_QUP6_I2C_APPS_CFG_RCGR_ADDR A:0x1807004
y.create.l HWIO_GCC_BLSP1_QUP1_SPI_APPS_CMD_RCGR_ADDR A:0x1802024
y.create.l HWIO_GCC_BLSP1_QUP1_SPI_APPS_CFG_RCGR_ADDR A:0x1802028
y.create.l HWIO_GCC_BLSP1_QUP1_SPI_APPS_M_ADDR A:0x180202c
y.create.l HWIO_GCC_BLSP1_QUP1_SPI_APPS_N_ADDR A:0x1802030
y.create.l HWIO_GCC_BLSP1_QUP1_SPI_APPS_D_ADDR A:0x1802034
y.create.l HWIO_GCC_BLSP1_UART1_BCR_ADDR A:0x1802038
y.create.l HWIO_GCC_BLSP1_UART1_APPS_CBCR_ADDR A:0x180203c
y.create.l HWIO_GCC_BLSP1_UART1_SIM_CBCR_ADDR A:0x1802040
y.create.l HWIO_GCC_BLSP1_UART1_APPS_CMD_RCGR_ADDR A:0x1802044
y.create.l HWIO_GCC_BLSP1_UART1_APPS_CFG_RCGR_ADDR A:0x1802048
y.create.l HWIO_GCC_BLSP1_UART1_APPS_M_ADDR A:0x180204c
y.create.l HWIO_GCC_BLSP1_UART1_APPS_N_ADDR A:0x1802050
y.create.l HWIO_GCC_BLSP1_UART1_APPS_D_ADDR A:0x1802054
y.create.l HWIO_GCC_BLSP1_QUP2_BCR_ADDR A:0x1803008
y.create.l HWIO_GCC_BLSP1_QUP2_SPI_APPS_CBCR_ADDR A:0x180300c
y.create.l HWIO_GCC_BLSP1_QUP2_I2C_APPS_CBCR_ADDR A:0x1803010
y.create.l HWIO_GCC_BLSP1_QUP2_SPI_APPS_CMD_RCGR_ADDR A:0x1803014
y.create.l HWIO_GCC_BLSP1_QUP2_SPI_APPS_CFG_RCGR_ADDR A:0x1803018
y.create.l HWIO_GCC_BLSP1_QUP2_SPI_APPS_M_ADDR A:0x180301c
y.create.l HWIO_GCC_BLSP1_QUP2_SPI_APPS_N_ADDR A:0x1803020
y.create.l HWIO_GCC_BLSP1_QUP2_SPI_APPS_D_ADDR A:0x1803024
y.create.l HWIO_GCC_BLSP1_UART2_BCR_ADDR A:0x1803028
y.create.l HWIO_GCC_BLSP1_UART2_APPS_CBCR_ADDR A:0x180302c
y.create.l HWIO_GCC_BLSP1_UART2_SIM_CBCR_ADDR A:0x1803030
y.create.l HWIO_GCC_BLSP1_UART2_APPS_CMD_RCGR_ADDR A:0x1803034
y.create.l HWIO_GCC_BLSP1_UART2_APPS_CFG_RCGR_ADDR A:0x1803038
y.create.l HWIO_GCC_BLSP1_UART2_APPS_M_ADDR A:0x180303c
y.create.l HWIO_GCC_BLSP1_UART2_APPS_N_ADDR A:0x1803040
y.create.l HWIO_GCC_BLSP1_UART2_APPS_D_ADDR A:0x1803044
y.create.l HWIO_GCC_BLSP1_QUP3_BCR_ADDR A:0x1804018
y.create.l HWIO_GCC_BLSP1_QUP3_SPI_APPS_CBCR_ADDR A:0x180401c
y.create.l HWIO_GCC_BLSP1_QUP3_I2C_APPS_CBCR_ADDR A:0x1804020
y.create.l HWIO_GCC_BLSP1_QUP3_SPI_APPS_CMD_RCGR_ADDR A:0x1804024
y.create.l HWIO_GCC_BLSP1_QUP3_SPI_APPS_CFG_RCGR_ADDR A:0x1804028
y.create.l HWIO_GCC_BLSP1_QUP3_SPI_APPS_M_ADDR A:0x180402c
y.create.l HWIO_GCC_BLSP1_QUP3_SPI_APPS_N_ADDR A:0x1804030
y.create.l HWIO_GCC_BLSP1_QUP3_SPI_APPS_D_ADDR A:0x1804034
y.create.l HWIO_GCC_BLSP1_UART3_BCR_ADDR A:0x1804038
y.create.l HWIO_GCC_BLSP1_UART3_APPS_CBCR_ADDR A:0x180403c
y.create.l HWIO_GCC_BLSP1_UART3_SIM_CBCR_ADDR A:0x1804040
y.create.l HWIO_GCC_BLSP1_UART3_APPS_CMD_RCGR_ADDR A:0x1804044
y.create.l HWIO_GCC_BLSP1_UART3_APPS_CFG_RCGR_ADDR A:0x1804048
y.create.l HWIO_GCC_BLSP1_UART3_APPS_M_ADDR A:0x180404c
y.create.l HWIO_GCC_BLSP1_UART3_APPS_N_ADDR A:0x1804050
y.create.l HWIO_GCC_BLSP1_UART3_APPS_D_ADDR A:0x1804054
y.create.l HWIO_GCC_BLSP1_QUP4_BCR_ADDR A:0x1805018
y.create.l HWIO_GCC_BLSP1_QUP4_SPI_APPS_CBCR_ADDR A:0x180501c
y.create.l HWIO_GCC_BLSP1_QUP4_I2C_APPS_CBCR_ADDR A:0x1805020
y.create.l HWIO_GCC_BLSP1_QUP4_SPI_APPS_CMD_RCGR_ADDR A:0x1805024
y.create.l HWIO_GCC_BLSP1_QUP4_SPI_APPS_CFG_RCGR_ADDR A:0x1805028
y.create.l HWIO_GCC_BLSP1_QUP4_SPI_APPS_M_ADDR A:0x180502c
y.create.l HWIO_GCC_BLSP1_QUP4_SPI_APPS_N_ADDR A:0x1805030
y.create.l HWIO_GCC_BLSP1_QUP4_SPI_APPS_D_ADDR A:0x1805034
y.create.l HWIO_GCC_BLSP1_UART4_BCR_ADDR A:0x1805038
y.create.l HWIO_GCC_BLSP1_UART4_APPS_CBCR_ADDR A:0x180503c
y.create.l HWIO_GCC_BLSP1_UART4_SIM_CBCR_ADDR A:0x1805040
y.create.l HWIO_GCC_BLSP1_UART4_APPS_CMD_RCGR_ADDR A:0x1805044
y.create.l HWIO_GCC_BLSP1_UART4_APPS_CFG_RCGR_ADDR A:0x1805048
y.create.l HWIO_GCC_BLSP1_UART4_APPS_M_ADDR A:0x180504c
y.create.l HWIO_GCC_BLSP1_UART4_APPS_N_ADDR A:0x1805050
y.create.l HWIO_GCC_BLSP1_UART4_APPS_D_ADDR A:0x1805054
y.create.l HWIO_GCC_BLSP1_QUP5_BCR_ADDR A:0x1806018
y.create.l HWIO_GCC_BLSP1_QUP5_SPI_APPS_CBCR_ADDR A:0x180601c
y.create.l HWIO_GCC_BLSP1_QUP5_I2C_APPS_CBCR_ADDR A:0x1806020
y.create.l HWIO_GCC_BLSP1_QUP5_SPI_APPS_CMD_RCGR_ADDR A:0x1806024
y.create.l HWIO_GCC_BLSP1_QUP5_SPI_APPS_CFG_RCGR_ADDR A:0x1806028
y.create.l HWIO_GCC_BLSP1_QUP5_SPI_APPS_M_ADDR A:0x180602c
y.create.l HWIO_GCC_BLSP1_QUP5_SPI_APPS_N_ADDR A:0x1806030
y.create.l HWIO_GCC_BLSP1_QUP5_SPI_APPS_D_ADDR A:0x1806034
y.create.l HWIO_GCC_BLSP1_UART5_BCR_ADDR A:0x1806038
y.create.l HWIO_GCC_BLSP1_UART5_APPS_CBCR_ADDR A:0x180603c
y.create.l HWIO_GCC_BLSP1_UART5_SIM_CBCR_ADDR A:0x1806040
y.create.l HWIO_GCC_BLSP1_UART5_APPS_CMD_RCGR_ADDR A:0x1806044
y.create.l HWIO_GCC_BLSP1_UART5_APPS_CFG_RCGR_ADDR A:0x1806048
y.create.l HWIO_GCC_BLSP1_UART5_APPS_M_ADDR A:0x180604c
y.create.l HWIO_GCC_BLSP1_UART5_APPS_N_ADDR A:0x1806050
y.create.l HWIO_GCC_BLSP1_UART5_APPS_D_ADDR A:0x1806054
y.create.l HWIO_GCC_BLSP1_QUP6_BCR_ADDR A:0x1807018
y.create.l HWIO_GCC_BLSP1_QUP6_SPI_APPS_CBCR_ADDR A:0x180701c
y.create.l HWIO_GCC_BLSP1_QUP6_I2C_APPS_CBCR_ADDR A:0x1807020
y.create.l HWIO_GCC_BLSP1_QUP6_SPI_APPS_CMD_RCGR_ADDR A:0x1807024
y.create.l HWIO_GCC_BLSP1_QUP6_SPI_APPS_CFG_RCGR_ADDR A:0x1807028
y.create.l HWIO_GCC_BLSP1_QUP6_SPI_APPS_M_ADDR A:0x180702c
y.create.l HWIO_GCC_BLSP1_QUP6_SPI_APPS_N_ADDR A:0x1807030
y.create.l HWIO_GCC_BLSP1_QUP6_SPI_APPS_D_ADDR A:0x1807034
y.create.l HWIO_GCC_BLSP1_UART6_BCR_ADDR A:0x1807038
y.create.l HWIO_GCC_BLSP1_UART6_APPS_CBCR_ADDR A:0x180703c
y.create.l HWIO_GCC_BLSP1_UART6_SIM_CBCR_ADDR A:0x1807040
y.create.l HWIO_GCC_BLSP1_UART6_APPS_CMD_RCGR_ADDR A:0x1807044
y.create.l HWIO_GCC_BLSP1_UART6_APPS_CFG_RCGR_ADDR A:0x1807048
y.create.l HWIO_GCC_BLSP1_UART6_APPS_M_ADDR A:0x180704c
y.create.l HWIO_GCC_BLSP1_UART6_APPS_N_ADDR A:0x1807050
y.create.l HWIO_GCC_BLSP1_UART6_APPS_D_ADDR A:0x1807054
y.create.l HWIO_GCC_BLSP_UART_SIM_CMD_RCGR_ADDR A:0x180100c
y.create.l HWIO_GCC_BLSP_UART_SIM_CFG_RCGR_ADDR A:0x1801010
y.create.l HWIO_GCC_PRNG_XPU_CFG_AHB_CBCR_ADDR A:0x1817008
y.create.l HWIO_GCC_PDM_BCR_ADDR A:0x1844000
y.create.l HWIO_GCC_PDM_AHB_CBCR_ADDR A:0x1844004
y.create.l HWIO_GCC_PDM_XO4_CBCR_ADDR A:0x1844008
y.create.l HWIO_GCC_PDM2_CBCR_ADDR A:0x184400c
y.create.l HWIO_GCC_PDM2_CMD_RCGR_ADDR A:0x1844010
y.create.l HWIO_GCC_PDM2_CFG_RCGR_ADDR A:0x1844014
y.create.l HWIO_GCC_PRNG_BCR_ADDR A:0x1813000
y.create.l HWIO_GCC_PRNG_AHB_CBCR_ADDR A:0x1813004
y.create.l HWIO_GCC_TCSR_BCR_ADDR A:0x1828000
y.create.l HWIO_GCC_TCSR_AHB_CBCR_ADDR A:0x1828004
y.create.l HWIO_GCC_BOOT_ROM_BCR_ADDR A:0x1813008
y.create.l HWIO_GCC_BOOT_ROM_AHB_CBCR_ADDR A:0x181300c
y.create.l HWIO_GCC_MSG_RAM_BCR_ADDR A:0x182b000
y.create.l HWIO_GCC_MSG_RAM_AHB_CBCR_ADDR A:0x182b004
y.create.l HWIO_GCC_TLMM_BCR_ADDR A:0x1834000
y.create.l HWIO_GCC_TLMM_AHB_CBCR_ADDR A:0x1834004
y.create.l HWIO_GCC_TLMM_CBCR_ADDR A:0x1834008
y.create.l HWIO_GCC_MPM_BCR_ADDR A:0x182c000
y.create.l HWIO_GCC_MPM_MISC_ADDR A:0x182c004
y.create.l HWIO_GCC_MPM_AHB_CBCR_ADDR A:0x182c008
y.create.l HWIO_GCC_RPM_PROC_HCLK_CBCR_ADDR A:0x182d000
y.create.l HWIO_GCC_RPM_BUS_AHB_CBCR_ADDR A:0x182d004
y.create.l HWIO_GCC_RPM_SLEEP_CBCR_ADDR A:0x182d008
y.create.l HWIO_GCC_RPM_TIMER_CBCR_ADDR A:0x182d00c
y.create.l HWIO_GCC_RPM_CMD_RCGR_ADDR A:0x182d010
y.create.l HWIO_GCC_RPM_CFG_RCGR_ADDR A:0x182d014
y.create.l HWIO_GCC_RPM_MISC_ADDR A:0x182d028
y.create.l HWIO_GCC_SEC_CTRL_BCR_ADDR A:0x181a000
y.create.l HWIO_GCC_ACC_CMD_RCGR_ADDR A:0x181a004
y.create.l HWIO_GCC_ACC_CFG_RCGR_ADDR A:0x181a008
y.create.l HWIO_GCC_ACC_MISC_ADDR A:0x181a01c
y.create.l HWIO_GCC_SEC_CTRL_ACC_CBCR_ADDR A:0x181a020
y.create.l HWIO_GCC_SEC_CTRL_AHB_CBCR_ADDR A:0x181a024
y.create.l HWIO_GCC_SEC_CTRL_CBCR_ADDR A:0x181a028
y.create.l HWIO_GCC_SEC_CTRL_SENSE_CBCR_ADDR A:0x181a02c
y.create.l HWIO_GCC_SEC_CTRL_BOOT_ROM_PATCH_CBCR_ADDR A:0x181a030
y.create.l HWIO_GCC_SEC_CTRL_CMD_RCGR_ADDR A:0x181a034
y.create.l HWIO_GCC_SEC_CTRL_CFG_RCGR_ADDR A:0x181a038
y.create.l HWIO_GCC_SPMI_BCR_ADDR A:0x182e000
y.create.l HWIO_GCC_SPMI_SER_CMD_RCGR_ADDR A:0x182e004
y.create.l HWIO_GCC_SPMI_SER_CFG_RCGR_ADDR A:0x182e008
y.create.l HWIO_GCC_SPMI_SER_CBCR_ADDR A:0x182e01c
y.create.l HWIO_GCC_SPMI_PCNOC_AHB_CBCR_ADDR A:0x182e020
y.create.l HWIO_GCC_SPMI_AHB_CMD_RCGR_ADDR A:0x182e024
y.create.l HWIO_GCC_SPMI_AHB_CFG_RCGR_ADDR A:0x182e028
y.create.l HWIO_GCC_SPMI_AHB_CBCR_ADDR A:0x182e03c
y.create.l HWIO_GCC_SPDM_BCR_ADDR A:0x182f000
y.create.l HWIO_GCC_SPDM_CFG_AHB_CBCR_ADDR A:0x182f004
y.create.l HWIO_GCC_SPDM_MSTR_AHB_CBCR_ADDR A:0x182f008
y.create.l HWIO_GCC_SPDM_FF_CBCR_ADDR A:0x182f00c
y.create.l HWIO_GCC_SPDM_BIMC_CY_CBCR_ADDR A:0x182f010
y.create.l HWIO_GCC_SPDM_DEBUG_CY_CBCR_ADDR A:0x182f018
y.create.l HWIO_GCC_SPDM_PCNOC_CY_CBCR_ADDR A:0x182f01c
y.create.l HWIO_GCC_SPDM_RPM_CY_CBCR_ADDR A:0x182f020
y.create.l HWIO_GCC_CRYPTO_BCR_ADDR A:0x1816000
y.create.l HWIO_GCC_CRYPTO_CMD_RCGR_ADDR A:0x1816004
y.create.l HWIO_GCC_CRYPTO_CFG_RCGR_ADDR A:0x1816008
y.create.l HWIO_GCC_CRYPTO_CBCR_ADDR A:0x181601c
y.create.l HWIO_GCC_CRYPTO_AXI_CBCR_ADDR A:0x1816020
y.create.l HWIO_GCC_CRYPTO_AHB_CBCR_ADDR A:0x1816024
y.create.l HWIO_GCC_GCC_AHB_CBCR_ADDR A:0x1830014
y.create.l HWIO_GCC_GCC_XO_CMD_RCGR_ADDR A:0x1830018
y.create.l HWIO_GCC_GCC_XO_CBCR_ADDR A:0x1830030
y.create.l HWIO_GCC_GCC_XO_DIV4_CBCR_ADDR A:0x1830034
y.create.l HWIO_GCC_GCC_IM_SLEEP_CBCR_ADDR A:0x1830038
y.create.l HWIO_GCC_BIMC_BCR_ADDR A:0x1831000
y.create.l HWIO_GCC_BIMC_GDSCR_ADDR A:0x1831004
y.create.l HWIO_GCC_BIMC_DDR_XO_CMD_RCGR_ADDR A:0x1832000
y.create.l HWIO_GCC_BIMC_XO_CBCR_ADDR A:0x1831008
y.create.l HWIO_GCC_BIMC_CFG_AHB_CBCR_ADDR A:0x183100c
y.create.l HWIO_GCC_BIMC_SLEEP_CBCR_ADDR A:0x1831010
y.create.l HWIO_GCC_BIMC_PCNOC_AXI_CBCR_ADDR A:0x1831024
y.create.l HWIO_GCC_BIMC_DDR_CMD_RCGR_ADDR A:0x1832004
y.create.l HWIO_GCC_BIMC_DDR_CFG_RCGR_ADDR A:0x1832008
y.create.l HWIO_GCC_BIMC_MISC_ADDR A:0x1831018
y.create.l HWIO_GCC_BIMC_CBCR_ADDR A:0x183101c
y.create.l HWIO_GCC_BIMC_APSS_AXI_CBCR_ADDR A:0x1831020
y.create.l HWIO_GCC_DDR_DIM_CFG_CBCR_ADDR A:0x183201c
y.create.l HWIO_GCC_DDR_DIM_SLEEP_CBCR_ADDR A:0x1832020
y.create.l HWIO_GCC_APSS_TCU_CMD_RCGR_ADDR A:0x1837000
y.create.l HWIO_GCC_APSS_TCU_CFG_RCGR_ADDR A:0x1837004
y.create.l HWIO_GCC_BIMC_MSS_CMD_RCGR_ADDR A:0x1831050
y.create.l HWIO_GCC_BIMC_MSS_CFG_RCGR_ADDR A:0x1831054
y.create.l HWIO_GCC_BIMC_TCU_CBCR_ADDR A:0x1831044
y.create.l HWIO_GCC_ULTAUDIO_PCNOC_MPORT_CBCR_ADDR A:0x181c000
y.create.l HWIO_GCC_ULTAUDIO_PCNOC_SWAY_CBCR_ADDR A:0x181c004
y.create.l HWIO_GCC_ULT_AUDIO_BCR_ADDR A:0x181c0b4
y.create.l HWIO_GCC_APSS_AHB_CMD_RCGR_ADDR A:0x1846000
y.create.l HWIO_GCC_APSS_AHB_CFG_RCGR_ADDR A:0x1846004
y.create.l HWIO_GCC_APSS_AHB_MISC_ADDR A:0x1846018
y.create.l HWIO_GCC_APSS_AHB_CBCR_ADDR A:0x184601c
y.create.l HWIO_GCC_APSS_AXI_CBCR_ADDR A:0x1846020
y.create.l HWIO_GCC_SNOC_BUS_TIMEOUT0_BCR_ADDR A:0x1847000
y.create.l HWIO_GCC_SNOC_BUS_TIMEOUT0_AHB_CBCR_ADDR A:0x1847004
y.create.l HWIO_GCC_PCNOC_BUS_TIMEOUT0_BCR_ADDR A:0x1848000
y.create.l HWIO_GCC_PCNOC_BUS_TIMEOUT0_AHB_CBCR_ADDR A:0x1848004
y.create.l HWIO_GCC_PCNOC_BUS_TIMEOUT1_BCR_ADDR A:0x1848008
y.create.l HWIO_GCC_PCNOC_BUS_TIMEOUT1_AHB_CBCR_ADDR A:0x184800c
y.create.l HWIO_GCC_PCNOC_BUS_TIMEOUT2_BCR_ADDR A:0x1848010
y.create.l HWIO_GCC_PCNOC_BUS_TIMEOUT2_AHB_CBCR_ADDR A:0x1848014
y.create.l HWIO_GCC_PCNOC_BUS_TIMEOUT3_BCR_ADDR A:0x1848018
y.create.l HWIO_GCC_PCNOC_BUS_TIMEOUT3_AHB_CBCR_ADDR A:0x184801c
y.create.l HWIO_GCC_PCNOC_BUS_TIMEOUT4_BCR_ADDR A:0x1848020
y.create.l HWIO_GCC_PCNOC_BUS_TIMEOUT4_AHB_CBCR_ADDR A:0x1848024
y.create.l HWIO_GCC_PCNOC_BUS_TIMEOUT5_BCR_ADDR A:0x1848028
y.create.l HWIO_GCC_PCNOC_BUS_TIMEOUT5_AHB_CBCR_ADDR A:0x184802c
y.create.l HWIO_GCC_PCNOC_BUS_TIMEOUT6_BCR_ADDR A:0x1848030
y.create.l HWIO_GCC_PCNOC_BUS_TIMEOUT6_AHB_CBCR_ADDR A:0x1848034
y.create.l HWIO_GCC_PCNOC_BUS_TIMEOUT7_BCR_ADDR A:0x1848038
y.create.l HWIO_GCC_PCNOC_BUS_TIMEOUT7_AHB_CBCR_ADDR A:0x184803c
y.create.l HWIO_GCC_PCNOC_BUS_TIMEOUT8_BCR_ADDR A:0x1848040
y.create.l HWIO_GCC_PCNOC_BUS_TIMEOUT8_AHB_CBCR_ADDR A:0x1848044
y.create.l HWIO_GCC_PCNOC_BUS_TIMEOUT9_BCR_ADDR A:0x1848048
y.create.l HWIO_GCC_PCNOC_BUS_TIMEOUT9_AHB_CBCR_ADDR A:0x184804c
y.create.l HWIO_GCC_DEHR_BCR_ADDR A:0x181f000
y.create.l HWIO_GCC_DEHR_CBCR_ADDR A:0x181f004
y.create.l HWIO_GCC_PCNOC_MPU_CFG_AHB_CBCR_ADDR A:0x181700c
y.create.l HWIO_GCC_APSS_TCU_ASYNC_CBCR_ADDR A:0x1812098
y.create.l HWIO_GCC_APSS_TCU_CBCR_ADDR A:0x1812018
y.create.l HWIO_GCC_MSS_TBU_AXI_CBCR_ADDR A:0x1812024
y.create.l HWIO_GCC_MSS_TBU_GSS_AXI_CBCR_ADDR A:0x1812028
y.create.l HWIO_GCC_MSS_TBU_Q6_AXI_CBCR_ADDR A:0x181202c
y.create.l HWIO_GCC_PCNOC_TBU_CBCR_ADDR A:0x1812030
y.create.l HWIO_GCC_SMMU_CFG_CBCR_ADDR A:0x1812038
y.create.l HWIO_GCC_SMMU_XPU_CBCR_ADDR A:0x1817010
y.create.l HWIO_GCC_BIMC_NOC_MPU_AHB_CBCR_ADDR A:0x1812100
y.create.l HWIO_GCC_SMMU_CATS_CBCR_ADDR A:0x187c004
y.create.l HWIO_GCC_SMMU_CATS_BCR_ADDR A:0x187c000
y.create.l HWIO_GCC_SMMU_BCR_ADDR A:0x1812000
y.create.l HWIO_GCC_APSS_TCU_BCR_ADDR A:0x1812050
y.create.l HWIO_GCC_MSS_TBU_AXI_BCR_ADDR A:0x1865000
y.create.l HWIO_GCC_MSS_TBU_Q6_AXI_BCR_ADDR A:0x1867000
y.create.l HWIO_GCC_MSS_TBU_GSS_AXI_BCR_ADDR A:0x1866000
y.create.l HWIO_GCC_SMMU_XPU_BCR_ADDR A:0x1812054
y.create.l HWIO_GCC_SMMU_CFG_BCR_ADDR A:0x181208c
y.create.l HWIO_GCC_PCNOC_TBU_BCR_ADDR A:0x1812058
y.create.l HWIO_GCC_RBCPR_BCR_ADDR A:0x1833000
y.create.l HWIO_GCC_RBCPR_CBCR_ADDR A:0x1833004
y.create.l HWIO_GCC_RBCPR_AHB_CBCR_ADDR A:0x1833008
y.create.l HWIO_GCC_RBCPR_CMD_RCGR_ADDR A:0x183300c
y.create.l HWIO_GCC_RBCPR_CFG_RCGR_ADDR A:0x1833010
y.create.l HWIO_GCC_RPM_GPLL_ENA_VOTE_ADDR A:0x1836000
y.create.l HWIO_GCC_RPM_CLOCK_BRANCH_ENA_VOTE_ADDR A:0x1836004
y.create.l HWIO_GCC_RPM_SMMU_CLOCK_BRANCH_ENA_VOTE_ADDR A:0x183600c
y.create.l HWIO_GCC_RPM_CLOCK_SLEEP_ENA_VOTE_ADDR A:0x1836008
y.create.l HWIO_GCC_RPM_SMMU_CLOCK_SLEEP_ENA_VOTE_ADDR A:0x1836010
y.create.l HWIO_GCC_APCS_GPLL_ENA_VOTE_ADDR A:0x1845000
y.create.l HWIO_GCC_APCS_CLOCK_BRANCH_ENA_VOTE_ADDR A:0x1845004
y.create.l HWIO_GCC_APCS_SMMU_CLOCK_BRANCH_ENA_VOTE_ADDR A:0x184500c
y.create.l HWIO_GCC_APCS_CLOCK_SLEEP_ENA_VOTE_ADDR A:0x1845008
y.create.l HWIO_GCC_APCS_SMMU_CLOCK_SLEEP_ENA_VOTE_ADDR A:0x1845010
y.create.l HWIO_GCC_APCS_TZ_GPLL_ENA_VOTE_ADDR A:0x1813010
y.create.l HWIO_GCC_APCS_TZ_CLOCK_BRANCH_ENA_VOTE_ADDR A:0x1813014
y.create.l HWIO_GCC_APCS_TZ_SMMU_CLOCK_BRANCH_ENA_VOTE_ADDR A:0x1813020
y.create.l HWIO_GCC_APCS_TZ_CLOCK_SLEEP_ENA_VOTE_ADDR A:0x1813018
y.create.l HWIO_GCC_APCS_TZ_SMMU_CLOCK_SLEEP_ENA_VOTE_ADDR A:0x1813024
y.create.l HWIO_GCC_APCS_HYP_GPLL_ENA_VOTE_ADDR A:0x1861000
y.create.l HWIO_GCC_APCS_HYP_CLOCK_BRANCH_ENA_VOTE_ADDR A:0x1861004
y.create.l HWIO_GCC_APCS_HYP_SMMU_CLOCK_BRANCH_ENA_VOTE_ADDR A:0x186100c
y.create.l HWIO_GCC_APCS_HYP_CLOCK_SLEEP_ENA_VOTE_ADDR A:0x1861008
y.create.l HWIO_GCC_APCS_HYP_SMMU_CLOCK_SLEEP_ENA_VOTE_ADDR A:0x1861010
y.create.l HWIO_GCC_MSS_Q6_GPLL_ENA_VOTE_ADDR A:0x181b000
y.create.l HWIO_GCC_MSS_Q6_CLOCK_BRANCH_ENA_VOTE_ADDR A:0x181b004
y.create.l HWIO_GCC_MSS_Q6_CLOCK_SLEEP_ENA_VOTE_ADDR A:0x181b008
y.create.l HWIO_GCC_SPARE_GPLL_ENA_VOTE_ADDR A:0x1800000
y.create.l HWIO_GCC_SPARE_CLOCK_BRANCH_ENA_VOTE_ADDR A:0x1800004
y.create.l HWIO_GCC_MSS_RESTART_ADDR A:0x183e000
y.create.l HWIO_GCC_RESET_DEBUG_ADDR A:0x1814000
y.create.l HWIO_GCC_FLUSH_ETR_DEBUG_TIMER_ADDR A:0x1815000
y.create.l HWIO_GCC_STOP_CAPTURE_DEBUG_TIMER_ADDR A:0x1815004
y.create.l HWIO_GCC_RESET_STATUS_ADDR A:0x1815008
y.create.l HWIO_GCC_SW_SRST_ADDR A:0x181500c
y.create.l HWIO_GCC_PROC_HALT_ADDR A:0x181301c
y.create.l HWIO_GCC_GCC_DEBUG_CLK_CTL_ADDR A:0x1874000
y.create.l HWIO_GCC_CLOCK_FRQ_MEASURE_CTL_ADDR A:0x1874004
y.create.l HWIO_GCC_CLOCK_FRQ_MEASURE_STATUS_ADDR A:0x1874008
y.create.l HWIO_GCC_PLLTEST_PAD_CFG_ADDR A:0x187400c
y.create.l HWIO_GCC_EMAC_0_AHB_CBCR_ADDR A:0x184e000
y.create.l HWIO_GCC_EMAC_0_BCR_ADDR A:0x184e004
y.create.l HWIO_GCC_EMAC_0_AXI_CBCR_ADDR A:0x184e008
y.create.l HWIO_GCC_EMAC_0_TX_CBCR_ADDR A:0x184e00c
y.create.l HWIO_GCC_EMAC_0_125M_CBCR_ADDR A:0x184e010
y.create.l HWIO_GCC_EMAC_0_TX_CMD_RCGR_ADDR A:0x184e014
y.create.l HWIO_GCC_EMAC_0_TX_CFG_RCGR_ADDR A:0x184e018
y.create.l HWIO_GCC_EMAC_0_TX_M_ADDR A:0x184e01c
y.create.l HWIO_GCC_EMAC_0_TX_N_ADDR A:0x184e020
y.create.l HWIO_GCC_EMAC_0_TX_D_ADDR A:0x184e024
y.create.l HWIO_GCC_EMAC_0_125M_CMD_RCGR_ADDR A:0x184e028
y.create.l HWIO_GCC_EMAC_0_125M_CFG_RCGR_ADDR A:0x184e02c
y.create.l HWIO_GCC_EMAC_0_RX_CBCR_ADDR A:0x184e030
y.create.l HWIO_GCC_EMAC_0_SYS_CBCR_ADDR A:0x184e034
y.create.l HWIO_GCC_EMAC_0_SYS_25M_CBCR_ADDR A:0x184e038
y.create.l HWIO_GCC_EMAC_0_SYS_25M_CMD_RCGR_ADDR A:0x184e03c
y.create.l HWIO_GCC_EMAC_0_SYS_25M_CFG_RCGR_ADDR A:0x184e040
y.create.l HWIO_GCC_JITTER_PROBE_CFG_ADDR A:0x1874010
y.create.l HWIO_GCC_JITTER_PROBE_VAL_ADDR A:0x1874014
y.create.l HWIO_GCC_GP1_CBCR_ADDR A:0x1808000
y.create.l HWIO_GCC_GP1_CMD_RCGR_ADDR A:0x1808004
y.create.l HWIO_GCC_GP1_CFG_RCGR_ADDR A:0x1808008
y.create.l HWIO_GCC_GP1_M_ADDR A:0x180800c
y.create.l HWIO_GCC_GP1_N_ADDR A:0x1808010
y.create.l HWIO_GCC_GP1_D_ADDR A:0x1808014
y.create.l HWIO_GCC_GP2_CBCR_ADDR A:0x1809000
y.create.l HWIO_GCC_GP2_CMD_RCGR_ADDR A:0x1809004
y.create.l HWIO_GCC_GP2_CFG_RCGR_ADDR A:0x1809008
y.create.l HWIO_GCC_GP2_M_ADDR A:0x180900c
y.create.l HWIO_GCC_GP2_N_ADDR A:0x1809010
y.create.l HWIO_GCC_GP2_D_ADDR A:0x1809014
y.create.l HWIO_GCC_GP3_CBCR_ADDR A:0x180a000
y.create.l HWIO_GCC_GP3_CMD_RCGR_ADDR A:0x180a004
y.create.l HWIO_GCC_GP3_CFG_RCGR_ADDR A:0x180a008
y.create.l HWIO_GCC_GP3_M_ADDR A:0x180a00c
y.create.l HWIO_GCC_GP3_N_ADDR A:0x180a010
y.create.l HWIO_GCC_GP3_D_ADDR A:0x180a014
y.create.l HWIO_GCC_APSS_MISC_ADDR A:0x1860000
y.create.l HWIO_GCC_TIC_MODE_APSS_BOOT_ADDR A:0x187f000
y.create.l HWIO_GCC_USB_BOOT_CLOCK_CTL_ADDR A:0x1840000
y.create.l HWIO_GCC_RAW_SLEEP_CLK_CTRL_ADDR A:0x1835000
y.create.l HWIO_GCC_S1LM_MODEM_DIV_VOTE_ADDR A:0x1800008
y.create.l HWIO_GCC_GCC_SPARE1_REG_ADDR A:0x180000c
y.create.l HWIO_GCC_S1LM_APPS_DIV_VOTE_ADDR A:0x187e000
y.create.l HWIO_GCC_GCC_SPARE3_REG_ADDR A:0x187e004
y.create.l HWIO_GCC_DCD_BCR_ADDR A:0x182a000
y.create.l HWIO_GCC_DCD_XO_CBCR_ADDR A:0x182a004
y.create.l HWIO_GCC_SNOC_DCD_CONFIG_ADDR A:0x182a008
y.create.l HWIO_GCC_SNOC_DCD_HYSTERESIS_CNT_ADDR A:0x182a00c
y.create.l HWIO_GCC_PCNOC_DCD_CONFIG_ADDR A:0x182a010
y.create.l HWIO_GCC_PCNOC_DCD_HYSTERESIS_CNT_ADDR A:0x182a014
y.create.l HWIO_GCC_AUDIO_CORE_BCR_ADDR A:0x181c008
y.create.l HWIO_GCC_ULTAUDIO_LPAIF_PRI_I2S_CMD_RCGR_ADDR A:0x181c054
y.create.l HWIO_GCC_ULTAUDIO_LPAIF_PRI_I2S_CFG_RCGR_ADDR A:0x181c058
y.create.l HWIO_GCC_ULTAUDIO_LPAIF_PRI_I2S_M_ADDR A:0x181c05c
y.create.l HWIO_GCC_ULTAUDIO_LPAIF_PRI_I2S_N_ADDR A:0x181c060
y.create.l HWIO_GCC_ULTAUDIO_LPAIF_PRI_I2S_D_ADDR A:0x181c064
y.create.l HWIO_GCC_ULTAUDIO_LPAIF_PRI_I2S_CBCR_ADDR A:0x181c068
y.create.l HWIO_GCC_ULTAUDIO_LPAIF_SEC_I2S_CMD_RCGR_ADDR A:0x181c06c
y.create.l HWIO_GCC_ULTAUDIO_LPAIF_SEC_I2S_CFG_RCGR_ADDR A:0x181c070
y.create.l HWIO_GCC_ULTAUDIO_LPAIF_SEC_I2S_M_ADDR A:0x181c074
y.create.l HWIO_GCC_ULTAUDIO_LPAIF_SEC_I2S_N_ADDR A:0x181c078
y.create.l HWIO_GCC_ULTAUDIO_LPAIF_SEC_I2S_D_ADDR A:0x181c07c
y.create.l HWIO_GCC_ULTAUDIO_LPAIF_SEC_I2S_CBCR_ADDR A:0x181c080
y.create.l HWIO_GCC_ULTAUDIO_XO_CMD_RCGR_ADDR A:0x181c034
y.create.l HWIO_GCC_ULTAUDIO_XO_CFG_RCGR_ADDR A:0x181c038
y.create.l HWIO_GCC_ULTAUDIO_AHBFABRIC_CMD_RCGR_ADDR A:0x181c010
y.create.l HWIO_GCC_ULTAUDIO_AHBFABRIC_CFG_RCGR_ADDR A:0x181c014
y.create.l HWIO_GCC_ULTAUDIO_AHBFABRIC_M_ADDR A:0x181c018
y.create.l HWIO_GCC_ULTAUDIO_AHBFABRIC_N_ADDR A:0x181c01c
y.create.l HWIO_GCC_ULTAUDIO_AHBFABRIC_D_ADDR A:0x181c020
y.create.l HWIO_GCC_ULTAUDIO_AHBFABRIC_IXFABRIC_LPM_CBCR_ADDR A:0x181c024
y.create.l HWIO_GCC_ULTAUDIO_AHBFABRIC_IXFABRIC_CBCR_ADDR A:0x181c028
y.create.l HWIO_GCC_ULTAUDIO_AVSYNC_XO_CBCR_ADDR A:0x181c04c
y.create.l HWIO_GCC_ULTAUDIO_STC_XO_CBCR_ADDR A:0x181c050
y.create.l HWIO_GCC_ULTAUDIO_AHBFABRIC_EFABRIC_SPDM_CBCR_ADDR A:0x181c030
y.create.l HWIO_GCC_ULTAUDIO_LPAIF_AUX_I2S_CMD_RCGR_ADDR A:0x181c084
y.create.l HWIO_GCC_ULTAUDIO_LPAIF_AUX_I2S_CFG_RCGR_ADDR A:0x181c088
y.create.l HWIO_GCC_ULTAUDIO_LPAIF_AUX_I2S_M_ADDR A:0x181c08c
y.create.l HWIO_GCC_ULTAUDIO_LPAIF_AUX_I2S_N_ADDR A:0x181c090
y.create.l HWIO_GCC_ULTAUDIO_LPAIF_AUX_I2S_D_ADDR A:0x181c094
y.create.l HWIO_GCC_ULTAUDIO_LPAIF_AUX_I2S_CBCR_ADDR A:0x181c098
y.create.l HWIO_GCC_ULTAUDIO_PCM_DATA_OE_CMD_RCGR_ADDR A:0x181c0f0
y.create.l HWIO_GCC_ULTAUDIO_PCM_DATA_OE_CFG_RCGR_ADDR A:0x181c0f4
y.create.l HWIO_GCC_ULTAUDIO_PCM_DATA_OE_M_ADDR A:0x181c0f8
y.create.l HWIO_GCC_ULTAUDIO_PCM_DATA_OE_N_ADDR A:0x181c0fc
y.create.l HWIO_GCC_ULTAUDIO_PCM_DATA_OE_D_ADDR A:0x181c100
y.create.l HWIO_GCC_ULTAUDIO_PCM_DATA_OE_CBCR_ADDR A:0x181c104
y.create.l HWIO_GCC_ULTAUDIO_SEC_PCM_DATA_OE_CMD_RCGR_ADDR A:0x181c108
y.create.l HWIO_GCC_ULTAUDIO_SEC_PCM_DATA_OE_CFG_RCGR_ADDR A:0x181c10c
y.create.l HWIO_GCC_ULTAUDIO_SEC_PCM_DATA_OE_M_ADDR A:0x181c110
y.create.l HWIO_GCC_ULTAUDIO_SEC_PCM_DATA_OE_N_ADDR A:0x181c114
y.create.l HWIO_GCC_ULTAUDIO_SEC_PCM_DATA_OE_D_ADDR A:0x181c118
y.create.l HWIO_GCC_ULTAUDIO_SEC_PCM_DATA_OE_CBCR_ADDR A:0x181c11c
y.create.l HWIO_GCC_ULTAUDIO_TER_PCM_DATA_OE_CMD_RCGR_ADDR A:0x181c120
y.create.l HWIO_GCC_ULTAUDIO_TER_PCM_DATA_OE_CFG_RCGR_ADDR A:0x181c124
y.create.l HWIO_GCC_ULTAUDIO_TER_PCM_DATA_OE_M_ADDR A:0x181c128
y.create.l HWIO_GCC_ULTAUDIO_TER_PCM_DATA_OE_N_ADDR A:0x181c12c
y.create.l HWIO_GCC_ULTAUDIO_TER_PCM_DATA_OE_D_ADDR A:0x181c130
y.create.l HWIO_GCC_ULTAUDIO_TER_PCM_DATA_OE_CBCR_ADDR A:0x181c134
y.create.l HWIO_GCC_ULTAUDIO_EXT_MCLK2_CMD_RCGR_ADDR A:0x181c0d8
y.create.l HWIO_GCC_ULTAUDIO_EXT_MCLK2_CFG_RCGR_ADDR A:0x181c0dc
y.create.l HWIO_GCC_ULTAUDIO_EXT_MCLK2_M_ADDR A:0x181c0e0
y.create.l HWIO_GCC_ULTAUDIO_EXT_MCLK2_N_ADDR A:0x181c0e4
y.create.l HWIO_GCC_ULTAUDIO_EXT_MCLK2_D_ADDR A:0x181c0e8
y.create.l HWIO_GCC_ULTAUDIO_EXT_MCLK2_CBCR_ADDR A:0x181c0ec
y.create.l HWIO_GCC_AUDIO_REF_CLOCK_SEL_ADDR A:0x181c0b8
y.create.l HWIO_GCC_RPU_XPU_SCR_ADDR A:0x1880000
y.create.l HWIO_GCC_RPU_XPU_SWDR_ADDR A:0x1880004
y.create.l HWIO_GCC_RPU_XPU_SEAR0_ADDR A:0x1880040
y.create.l HWIO_GCC_RPU_XPU_SESR_ADDR A:0x1880048
y.create.l HWIO_GCC_RPU_XPU_SESRRESTORE_ADDR A:0x188004c
y.create.l HWIO_GCC_RPU_XPU_SESYNR0_ADDR A:0x1880050
y.create.l HWIO_GCC_RPU_XPU_SESYNR1_ADDR A:0x1880054
y.create.l HWIO_GCC_RPU_XPU_SESYNR2_ADDR A:0x1880058
y.create.l HWIO_GCC_RPU_XPU_MCR_ADDR A:0x1880100
y.create.l HWIO_GCC_RPU_XPU_MEAR0_ADDR A:0x1880140
y.create.l HWIO_GCC_RPU_XPU_MESR_ADDR A:0x1880148
y.create.l HWIO_GCC_RPU_XPU_MESRRESTORE_ADDR A:0x188014c
y.create.l HWIO_GCC_RPU_XPU_MESYNR0_ADDR A:0x1880150
y.create.l HWIO_GCC_RPU_XPU_MESYNR1_ADDR A:0x1880154
y.create.l HWIO_GCC_RPU_XPU_MESYNR2_ADDR A:0x1880158
y.create.l HWIO_GCC_RPU_XPU_CR_ADDR A:0x1880080
y.create.l HWIO_GCC_RPU_XPU_RPU_ACR0_ADDR A:0x18800a0
y.create.l HWIO_GCC_RPU_XPU_EAR0_ADDR A:0x18800c0
y.create.l HWIO_GCC_RPU_XPU_ESR_ADDR A:0x18800c8
y.create.l HWIO_GCC_RPU_XPU_ESRRESTORE_ADDR A:0x18800cc
y.create.l HWIO_GCC_RPU_XPU_ESYNR0_ADDR A:0x18800d0
y.create.l HWIO_GCC_RPU_XPU_ESYNR1_ADDR A:0x18800d4
y.create.l HWIO_GCC_RPU_XPU_ESYNR2_ADDR A:0x18800d8
y.create.l HWIO_GCC_RPU_XPU_IDR0_ADDR A:0x1880074
y.create.l HWIO_GCC_RPU_XPU_IDR1_ADDR A:0x1880078
y.create.l HWIO_GCC_RPU_XPU_REV_ADDR A:0x188007c
y.create.l HWIO_GCC_RPU_XPU_RG0_RACR0_ADDR A:0x1880200
y.create.l HWIO_GCC_RPU_XPU_RG1_RACR0_ADDR A:0x1880280
y.create.l HWIO_GCC_RPU_XPU_RG2_RACR0_ADDR A:0x1880300
y.create.l HWIO_GCC_RPU_XPU_RG3_RACR0_ADDR A:0x1880380
y.create.l HWIO_GCC_RPU_XPU_RG4_RACR0_ADDR A:0x1880400
y.create.l HWIO_GCC_RPU_XPU_RG5_RACR0_ADDR A:0x1880480
y.create.l HWIO_GCC_RPU_XPU_RG6_RACR0_ADDR A:0x1880500
y.create.l HWIO_GCC_RPU_XPU_RG7_RACR0_ADDR A:0x1880580
y.create.l HWIO_GCC_RPU_XPU_RG8_RACR0_ADDR A:0x1880600
y.create.l HWIO_GCC_RPU_XPU_RG9_RACR0_ADDR A:0x1880680
y.create.l HWIO_GCC_RPU_XPU_RG0_WACR0_ADDR A:0x1880220
y.create.l HWIO_GCC_RPU_XPU_RG1_WACR0_ADDR A:0x18802a0
y.create.l HWIO_GCC_RPU_XPU_RG2_WACR0_ADDR A:0x1880320
y.create.l HWIO_GCC_RPU_XPU_RG3_WACR0_ADDR A:0x18803a0
y.create.l HWIO_GCC_RPU_XPU_RG4_WACR0_ADDR A:0x1880420
y.create.l HWIO_GCC_RPU_XPU_RG5_WACR0_ADDR A:0x18804a0
y.create.l HWIO_GCC_RPU_XPU_RG6_WACR0_ADDR A:0x1880520
y.create.l HWIO_GCC_RPU_XPU_RG7_WACR0_ADDR A:0x18805a0
y.create.l HWIO_GCC_RPU_XPU_RG8_WACR0_ADDR A:0x1880620
y.create.l HWIO_GCC_RPU_XPU_RG9_WACR0_ADDR A:0x18806a0
y.create.l HWIO_GCC_RPU_XPU_RG0_SCR_ADDR A:0x1880250
y.create.l HWIO_GCC_RPU_XPU_RG1_SCR_ADDR A:0x18802d0
y.create.l HWIO_GCC_RPU_XPU_RG2_SCR_ADDR A:0x1880350
y.create.l HWIO_GCC_RPU_XPU_RG3_SCR_ADDR A:0x18803d0
y.create.l HWIO_GCC_RPU_XPU_RG4_SCR_ADDR A:0x1880450
y.create.l HWIO_GCC_RPU_XPU_RG5_SCR_ADDR A:0x18804d0
y.create.l HWIO_GCC_RPU_XPU_RG6_SCR_ADDR A:0x1880550
y.create.l HWIO_GCC_RPU_XPU_RG7_SCR_ADDR A:0x18805d0
y.create.l HWIO_GCC_RPU_XPU_RG8_SCR_ADDR A:0x1880650
y.create.l HWIO_GCC_RPU_XPU_RG9_SCR_ADDR A:0x18806d0
y.create.l HWIO_GCC_RPU_XPU_RG0_MCR_ADDR A:0x1880254
y.create.l HWIO_GCC_RPU_XPU_RG1_MCR_ADDR A:0x18802d4
y.create.l HWIO_GCC_RPU_XPU_RG2_MCR_ADDR A:0x1880354
y.create.l HWIO_GCC_RPU_XPU_RG3_MCR_ADDR A:0x18803d4
y.create.l HWIO_GCC_RPU_XPU_RG4_MCR_ADDR A:0x1880454
y.create.l HWIO_GCC_RPU_XPU_RG5_MCR_ADDR A:0x18804d4
y.create.l HWIO_GCC_RPU_XPU_RG6_MCR_ADDR A:0x1880554
y.create.l HWIO_GCC_RPU_XPU_RG7_MCR_ADDR A:0x18805d4
y.create.l HWIO_GCC_RPU_XPU_RG8_MCR_ADDR A:0x1880654
y.create.l HWIO_GCC_RPU_XPU_RG9_MCR_ADDR A:0x18806d4
y.create.l HWIO_TCSR_MUTEX_REG_0_ADDR A:0x1905000
y.create.l HWIO_TCSR_MUTEX_REG_1_ADDR A:0x1906000
y.create.l HWIO_TCSR_MUTEX_REG_2_ADDR A:0x1907000
y.create.l HWIO_TCSR_MUTEX_REG_3_ADDR A:0x1908000
y.create.l HWIO_TCSR_MUTEX_REG_4_ADDR A:0x1909000
y.create.l HWIO_TCSR_MUTEX_REG_5_ADDR A:0x190a000
y.create.l HWIO_TCSR_MUTEX_REG_6_ADDR A:0x190b000
y.create.l HWIO_TCSR_MUTEX_REG_7_ADDR A:0x190c000
y.create.l HWIO_TCSR_MUTEX_REG_8_ADDR A:0x190d000
y.create.l HWIO_TCSR_MUTEX_REG_9_ADDR A:0x190e000
y.create.l HWIO_TCSR_REGS_XPU_SCR_ADDR A:0x1936000
y.create.l HWIO_TCSR_REGS_XPU_SWDR_ADDR A:0x1936004
y.create.l HWIO_TCSR_REGS_XPU_SEAR0_ADDR A:0x1936040
y.create.l HWIO_TCSR_REGS_XPU_SESR_ADDR A:0x1936048
y.create.l HWIO_TCSR_REGS_XPU_SESRRESTORE_ADDR A:0x193604c
y.create.l HWIO_TCSR_REGS_XPU_SESYNR0_ADDR A:0x1936050
y.create.l HWIO_TCSR_REGS_XPU_SESYNR1_ADDR A:0x1936054
y.create.l HWIO_TCSR_REGS_XPU_SESYNR2_ADDR A:0x1936058
y.create.l HWIO_TCSR_REGS_XPU_MCR_ADDR A:0x1936100
y.create.l HWIO_TCSR_REGS_XPU_MEAR0_ADDR A:0x1936140
y.create.l HWIO_TCSR_REGS_XPU_MESR_ADDR A:0x1936148
y.create.l HWIO_TCSR_REGS_XPU_MESRRESTORE_ADDR A:0x193614c
y.create.l HWIO_TCSR_REGS_XPU_MESYNR0_ADDR A:0x1936150
y.create.l HWIO_TCSR_REGS_XPU_MESYNR1_ADDR A:0x1936154
y.create.l HWIO_TCSR_REGS_XPU_MESYNR2_ADDR A:0x1936158
y.create.l HWIO_TCSR_REGS_XPU_CR_ADDR A:0x1936080
y.create.l HWIO_TCSR_REGS_XPU_RPU_ACR0_ADDR A:0x19360a0
y.create.l HWIO_TCSR_REGS_XPU_EAR0_ADDR A:0x19360c0
y.create.l HWIO_TCSR_REGS_XPU_ESR_ADDR A:0x19360c8
y.create.l HWIO_TCSR_REGS_XPU_ESRRESTORE_ADDR A:0x19360cc
y.create.l HWIO_TCSR_REGS_XPU_ESYNR0_ADDR A:0x19360d0
y.create.l HWIO_TCSR_REGS_XPU_ESYNR1_ADDR A:0x19360d4
y.create.l HWIO_TCSR_REGS_XPU_ESYNR2_ADDR A:0x19360d8
y.create.l HWIO_TCSR_REGS_XPU_IDR0_ADDR A:0x1936074
y.create.l HWIO_TCSR_REGS_XPU_IDR1_ADDR A:0x1936078
y.create.l HWIO_TCSR_REGS_XPU_REV_ADDR A:0x193607c
y.create.l HWIO_TCSR_REGS_XPU_RG0_RACR0_ADDR A:0x1936200
y.create.l HWIO_TCSR_REGS_XPU_RG1_RACR0_ADDR A:0x1936280
y.create.l HWIO_TCSR_REGS_XPU_RG2_RACR0_ADDR A:0x1936300
y.create.l HWIO_TCSR_REGS_XPU_RG3_RACR0_ADDR A:0x1936380
y.create.l HWIO_TCSR_REGS_XPU_RG4_RACR0_ADDR A:0x1936400
y.create.l HWIO_TCSR_REGS_XPU_RG5_RACR0_ADDR A:0x1936480
y.create.l HWIO_TCSR_REGS_XPU_RG6_RACR0_ADDR A:0x1936500
y.create.l HWIO_TCSR_REGS_XPU_RG7_RACR0_ADDR A:0x1936580
y.create.l HWIO_TCSR_REGS_XPU_RG8_RACR0_ADDR A:0x1936600
y.create.l HWIO_TCSR_REGS_XPU_RG9_RACR0_ADDR A:0x1936680
y.create.l HWIO_TCSR_REGS_XPU_RG0_WACR0_ADDR A:0x1936220
y.create.l HWIO_TCSR_REGS_XPU_RG1_WACR0_ADDR A:0x19362a0
y.create.l HWIO_TCSR_REGS_XPU_RG2_WACR0_ADDR A:0x1936320
y.create.l HWIO_TCSR_REGS_XPU_RG3_WACR0_ADDR A:0x19363a0
y.create.l HWIO_TCSR_REGS_XPU_RG4_WACR0_ADDR A:0x1936420
y.create.l HWIO_TCSR_REGS_XPU_RG5_WACR0_ADDR A:0x19364a0
y.create.l HWIO_TCSR_REGS_XPU_RG6_WACR0_ADDR A:0x1936520
y.create.l HWIO_TCSR_REGS_XPU_RG7_WACR0_ADDR A:0x19365a0
y.create.l HWIO_TCSR_REGS_XPU_RG8_WACR0_ADDR A:0x1936620
y.create.l HWIO_TCSR_REGS_XPU_RG9_WACR0_ADDR A:0x19366a0
y.create.l HWIO_TCSR_REGS_XPU_RG0_SCR_ADDR A:0x1936250
y.create.l HWIO_TCSR_REGS_XPU_RG1_SCR_ADDR A:0x19362d0
y.create.l HWIO_TCSR_REGS_XPU_RG2_SCR_ADDR A:0x1936350
y.create.l HWIO_TCSR_REGS_XPU_RG3_SCR_ADDR A:0x19363d0
y.create.l HWIO_TCSR_REGS_XPU_RG4_SCR_ADDR A:0x1936450
y.create.l HWIO_TCSR_REGS_XPU_RG5_SCR_ADDR A:0x19364d0
y.create.l HWIO_TCSR_REGS_XPU_RG6_SCR_ADDR A:0x1936550
y.create.l HWIO_TCSR_REGS_XPU_RG7_SCR_ADDR A:0x19365d0
y.create.l HWIO_TCSR_REGS_XPU_RG8_SCR_ADDR A:0x1936650
y.create.l HWIO_TCSR_REGS_XPU_RG9_SCR_ADDR A:0x19366d0
y.create.l HWIO_TCSR_REGS_XPU_RG0_MCR_ADDR A:0x1936254
y.create.l HWIO_TCSR_REGS_XPU_RG1_MCR_ADDR A:0x19362d4
y.create.l HWIO_TCSR_REGS_XPU_RG2_MCR_ADDR A:0x1936354
y.create.l HWIO_TCSR_REGS_XPU_RG3_MCR_ADDR A:0x19363d4
y.create.l HWIO_TCSR_REGS_XPU_RG4_MCR_ADDR A:0x1936454
y.create.l HWIO_TCSR_REGS_XPU_RG5_MCR_ADDR A:0x19364d4
y.create.l HWIO_TCSR_REGS_XPU_RG6_MCR_ADDR A:0x1936554
y.create.l HWIO_TCSR_REGS_XPU_RG7_MCR_ADDR A:0x19365d4
y.create.l HWIO_TCSR_REGS_XPU_RG8_MCR_ADDR A:0x1936654
y.create.l HWIO_TCSR_REGS_XPU_RG9_MCR_ADDR A:0x19366d4
y.create.l HWIO_TCSR_BIMC_CFG_QRIB_XPU2_INIT_ADDR A:0x1937100
y.create.l HWIO_TCSR_BIMC_QXS0_QRIB_XPU2_INIT_ADDR A:0x1937104
y.create.l HWIO_TCSR_MMSS_VENUS0_VBIF_QRIB_XPU2_INIT_ADDR A:0x1937380
y.create.l HWIO_TCSR_MMSS_VENUS0_WRAPPER_QRIB_XPU2_INIT_ADDR A:0x1937384
y.create.l HWIO_TCSR_BIMC_CFG_QRIB_XPU2_ACR_ADDR A:0x1938000
y.create.l HWIO_TCSR_BIMC_CFG_QRIB_XPU2_VMIDEN_INIT_ADDR A:0x1938004
y.create.l HWIO_TCSR_BIMC_QXS0_QRIB_XPU2_ACR_ADDR A:0x1938008
y.create.l HWIO_TCSR_BIMC_QXS0_QRIB_XPU2_VMIDEN_INIT_ADDR A:0x193800c
y.create.l HWIO_TCSR_MMSS_VENUS0_VBIF_QRIB_XPU2_ACR_ADDR A:0x1938380
y.create.l HWIO_TCSR_MMSS_VENUS0_VBIF_QRIB_XPU2_VMIDEN_INIT_ADDR A:0x1938384
y.create.l HWIO_TCSR_MMSS_VENUS0_WRAPPER_QRIB_XPU2_ACR_ADDR A:0x1938390
y.create.l HWIO_TCSR_MMSS_VENUS0_WRAPPER_QRIB_XPU2_VMIDEN_INIT_ADDR A:0x1938394
y.create.l HWIO_TCSR_SS_XPU2_NON_SEC_INTR0_ADDR A:0x1939000
y.create.l HWIO_TCSR_SS_XPU2_NON_SEC_INTR0_ENABLE_ADDR A:0x1939040
y.create.l HWIO_TCSR_SS_VMIDMT_CLIENT_NON_SEC_INTR_ADDR A:0x1939010
y.create.l HWIO_TCSR_SS_VMIDMT_CLIENT_NON_SEC_INTR_ENABLE_ADDR A:0x1939050
y.create.l HWIO_TCSR_SS_VMIDMT_CFG_NON_SEC_INTR_ADDR A:0x1939090
y.create.l HWIO_TCSR_SS_VMIDMT_CFG_NON_SEC_INTR_ENABLE_ADDR A:0x19390d0
y.create.l HWIO_TCSR_MUTEX_REG_RESET_ADDR A:0x1939800
y.create.l HWIO_TCSR_SS_XPU2_SEC_INTR0_ADDR A:0x1939400
y.create.l HWIO_TCSR_SS_XPU2_SEC_INTR0_ENABLE_ADDR A:0x1939440
y.create.l HWIO_TCSR_SS_VMIDMT_CLIENT_SEC_INTR_ADDR A:0x1939410
y.create.l HWIO_TCSR_SS_VMIDMT_CLIENT_SEC_INTR_ENABLE_ADDR A:0x1939450
y.create.l HWIO_TCSR_SS_VMIDMT_CFG_SEC_INTR_ADDR A:0x1939490
y.create.l HWIO_TCSR_SS_VMIDMT_CFG_SEC_INTR_ENABLE_ADDR A:0x19394d0
y.create.l HWIO_TCSR_SS_XPU2_MSA_INTR0_ADDR A:0x193a000
y.create.l HWIO_TCSR_SS_XPU2_MSA_INTR0_ENABLE_ADDR A:0x193a010
y.create.l HWIO_TCSR_MSA_BIT_REG_ADDR A:0x193a100
y.create.l HWIO_TCSR_TCSR_CLK_EN_ADDR A:0x193b07c
y.create.l HWIO_TCSR_TIMEOUT_SLAVE_GLB_EN_ADDR A:0x193c000
y.create.l HWIO_TCSR_XPU_NSEN_STATUS_ADDR A:0x193c004
y.create.l HWIO_TCSR_XPU_VMIDEN_STATUS_ADDR A:0x193c008
y.create.l HWIO_TCSR_XPU_MSAEN_STATUS_ADDR A:0x193c00c
y.create.l HWIO_TCSR_MDP3_TIMEOUT_VAL_0_ADDR_ADDR A:0x193c014
y.create.l HWIO_TCSR_MDP3_TIMEOUT_VAL_1_ADDR_ADDR A:0x193c018
y.create.l HWIO_TCSR_MDP3_TIMEOUT_EN_ADDR A:0x193c01c
y.create.l HWIO_TCSR_TZ_WONCE_0_ADDR A:0x193d000
y.create.l HWIO_TCSR_TZ_WONCE_1_ADDR A:0x193d004
y.create.l HWIO_TCSR_TZ_WONCE_2_ADDR A:0x193d008
y.create.l HWIO_TCSR_TZ_WONCE_3_ADDR A:0x193d00c
y.create.l HWIO_TCSR_TZ_WONCE_4_ADDR A:0x193d010
y.create.l HWIO_TCSR_TZ_WONCE_5_ADDR A:0x193d014
y.create.l HWIO_TCSR_TZ_WONCE_6_ADDR A:0x193d018
y.create.l HWIO_TCSR_TZ_WONCE_7_ADDR A:0x193d01c
y.create.l HWIO_TCSR_TZ_WONCE_8_ADDR A:0x193d020
y.create.l HWIO_TCSR_TZ_WONCE_9_ADDR A:0x193d024
y.create.l HWIO_TCSR_GCC_CLK_MUX_SEL_ADDR A:0x193d0f0
y.create.l HWIO_TCSR_BOOT_MISC_DETECT_ADDR A:0x193d100
y.create.l HWIO_TCSR_APSS_VMID_ADDR A:0x193d110
y.create.l HWIO_TCSR_MMSS_RPM_IRQ_EN_ADDR A:0x193e000
y.create.l HWIO_TCSR_MMSS_RPM_IRQ_CLEAR_ADDR A:0x193e004
y.create.l HWIO_TCSR_MMSS_RPM_IRQ_STATUS_ADDR A:0x193e008
y.create.l HWIO_TCSR_MMSS_OXILI_GC_SYS_AHB_STATUS_ADDR A:0x193e010
y.create.l HWIO_TCSR_MMSS_OXILI_CMD_REG_ADDR A:0x193e014
y.create.l HWIO_TCSR_MMSS_DSI_ULP_CLAMP_CTRL_ADDR A:0x193e020
y.create.l HWIO_TCSR_MMSS_DSI_PHYRESET_CTRL_ADDR A:0x193e024
y.create.l HWIO_TCSR_MMSS_IMEM_FSCGC_TIMERS_ADDR A:0x193e030
y.create.l HWIO_TCSR_MMSS_IMEM_EX_FSCGC_CONTROL_ADDR A:0x193e034
y.create.l HWIO_TCSR_MMSS_IMEM_RAM_CONFIG_ADDR A:0x193e038
y.create.l HWIO_TCSR_TBU_BYPASS_ENABLE_ADDR A:0x193f000
y.create.l HWIO_TCSR_RESET_DEBUG_SW_ENTRY_ADDR A:0x1940000
y.create.l HWIO_TCSR_QPDI_DISABLE_CFG_ADDR A:0x1941000
y.create.l HWIO_TCSR_COMPILER_VDDCX_ACC_0_ADDR A:0x1942080
y.create.l HWIO_TCSR_COMPILER_VDDCX_ACC_1_ADDR A:0x1942084
y.create.l HWIO_TCSR_CUSTOM_VDDCX_ACC_0_ADDR A:0x1942090
y.create.l HWIO_TCSR_CUSTOM_VDDCX_ACC_1_ADDR A:0x1942094
y.create.l HWIO_TCSR_MEM_ACC_SEL_VDDCX_ADDR A:0x1942100
y.create.l HWIO_TCSR_TCSR_S1LM_MODEM_TO_APPS_INT_ADDR A:0x1946000
y.create.l HWIO_TCSR_TCSR_S1LM_MODEM_TO_APPS_INT_DATA_ADDR A:0x1946004
y.create.l HWIO_TCSR_SPARE_APU_REG2_ADDR A:0x1946008
y.create.l HWIO_TCSR_SPARE_APU_REG3_ADDR A:0x194600c
y.create.l HWIO_TCSR_SYS_POWER_CTRL_ADDR A:0x1947000
y.create.l HWIO_TCSR_USB_CORE_ID_ADDR A:0x1947004
y.create.l HWIO_TCSR_TEST_SPARE_CFG_REG_ADDR_ADDR A:0x1947508
y.create.l HWIO_TCSR_COMPILER_VDDMSS_ACC_0_ADDR A:0x1942104
y.create.l HWIO_TCSR_COMPILER_VDDMSS_ACC_1_ADDR A:0x1942108
y.create.l HWIO_TCSR_COMPILER_VDDAPC_ACC_0_ADDR A:0x194210c
y.create.l HWIO_TCSR_COMPILER_VDDAPC_ACC_1_ADDR A:0x1942110
y.create.l HWIO_TCSR_CUSTOM_VDDAPC_ACC_0_ADDR A:0x1942120
y.create.l HWIO_TCSR_CUSTOM_VDDAPC_ACC_1_ADDR A:0x1942124
y.create.l HWIO_TCSR_CUSTOM_VDDAPC_ACC_2_ADDR A:0x1942128
y.create.l HWIO_TCSR_MEM_ACC_SEL_VDDMSS_ADDR A:0x194212c
y.create.l HWIO_TCSR_MEM_ACC_SEL_VDDAPC_ADDR A:0x1942130
y.create.l HWIO_TCSR_CUSTOM_VDDCX_ACC_2_ADDR A:0x1942134
y.create.l HWIO_TCSR_LDO_SLEEP_CTRL_ADDR A:0x1948000
y.create.l HWIO_TCSR_LDO_UPDATE_STATE_CTRL_ADDR A:0x1948004
y.create.l HWIO_TCSR_LDO_OBIAS_CTRL_ADDR A:0x1948008
y.create.l HWIO_TCSR_LDO_VREF_CONFIG_ADDR A:0x194800c
y.create.l HWIO_TCSR_LDO_IB_CONFIG_ADDR A:0x1948010
y.create.l HWIO_TCSR_LDO_BGC_CONFIG_ADDR A:0x1948014
y.create.l HWIO_TCSR_LDO_VREF_CTRL_ADDR A:0x1948018
y.create.l HWIO_TCSR_LDO_LD_EN_ADDR A:0x194801c
y.create.l HWIO_TCSR_LDO_LD_CTRL_ADDR A:0x1948020
y.create.l HWIO_TCSR_LDO_OSC_RESETB_ADDR A:0x1948024
y.create.l HWIO_TCSR_LDO_OSC_CTRL_ADDR A:0x1948028
y.create.l HWIO_TCSR_LDO_DFT_EN_CTRL_ADDR A:0x194802c
y.create.l HWIO_TCSR_LDO_DFT_CTRL_ADDR A:0x1948030
y.create.l HWIO_TCSR_SPDM_CNT_CLK_CTRL_ADDR A:0x194a000
y.create.l HWIO_TCSR_SPDM_DLY_FIFO_EN_ADDR A:0x194a004
y.create.l HWIO_TCSR_SPDM_STG1_MUX_SEL_ADDR A:0x194a008
y.create.l HWIO_TCSR_SPDM_STG2_A_MUX_SEL_ADDR A:0x194a00c
y.create.l HWIO_TCSR_SPDM_STG2_B_MUX_SEL_ADDR A:0x194a010
y.create.l HWIO_TCSR_SPDM_STG3_A_MUX_SEL_ADDR A:0x194a014
y.create.l HWIO_TCSR_SPDM_STG3_B_MUX_SEL_ADDR A:0x194a018
y.create.l HWIO_TCSR_PHSS_USB2_PHY_SEL_ADDR A:0x194b000
y.create.l HWIO_TCSR_PHSS_ATEST_USB2_PHY_SEL_ADDR A:0x194b004
y.create.l HWIO_TCSR_PHSS_TEST_BUS_SEL_ADDR A:0x194b008
y.create.l HWIO_TCSR_PHSS_UART_PRONTO_INT_SEL_0_ADDR A:0x194b080
y.create.l HWIO_TCSR_PHSS_UART_PRONTO_INT_SEL_1_ADDR A:0x194b090
y.create.l HWIO_TCSR_PHSS_UART_MSS_INT_SEL_0_ADDR A:0x194b0c0
y.create.l HWIO_TCSR_PHSS_UART_MSS_INT_SEL_1_ADDR A:0x194b0d0
y.create.l HWIO_TCSR_PHSS_QUP_PRONTO_INT_SEL_0_ADDR A:0x194b100
y.create.l HWIO_TCSR_PHSS_QUP_PRONTO_INT_SEL_1_ADDR A:0x194b110
y.create.l HWIO_TCSR_PHSS_QUP_MSS_INT_SEL_0_ADDR A:0x194b140
y.create.l HWIO_TCSR_PHSS_QUP_MSS_INT_SEL_1_ADDR A:0x194b150
y.create.l HWIO_TCSR_MEM_ARRY_STBY_ADDR A:0x194c180
y.create.l HWIO_TCSR_SOC_HW_VERSION_ADDR A:0x194d000
y.create.l HWIO_TCSR_TIMEOUT_INTR_STATUS_ADDR A:0x194d020
y.create.l HWIO_TCSR_TIMEOUT_INTR_RPM_ENABLE_ADDR A:0x194d030
y.create.l HWIO_TCSR_TIMEOUT_INTR_APSS_ENABLE_ADDR A:0x194d040
y.create.l HWIO_TCSR_TIMEOUT_INTR_MSS_ENABLE_ADDR A:0x194d060
y.create.l HWIO_TCSR_PRONTO_BUS_TIMEOUT_RESET_ADDR A:0x194d070
y.create.l HWIO_TCSR_CRYPTO0_HALTREQ_ADDR A:0x194e000
y.create.l HWIO_TCSR_CRYPTO0_HALTACK_ADDR A:0x194e004
y.create.l HWIO_TCSR_CRYPTO0_MASTER_IDLE_ADDR A:0x194e008
y.create.l HWIO_TCSR_MSSQ6_HALTREQ_ADDR A:0x194f000
y.create.l HWIO_TCSR_MSSQ6_HALTACK_ADDR A:0x194f004
y.create.l HWIO_TCSR_MSSQ6_MASTER_IDLE_ADDR A:0x194f008
y.create.l HWIO_TCSR_MSSQ6_POWER_STATE_ADDR A:0x194f010
y.create.l HWIO_TCSR_MSS_MODEM_HALTREQ_ADDR A:0x1950000
y.create.l HWIO_TCSR_MSS_MODEM_HALTACK_ADDR A:0x1950004
y.create.l HWIO_TCSR_MSS_MODEM_MASTER_IDLE_ADDR A:0x1950008
y.create.l HWIO_TCSR_MSS_NC_HALTREQ_ADDR A:0x1951000
y.create.l HWIO_TCSR_MSS_NC_HALTACK_ADDR A:0x1951004
y.create.l HWIO_TCSR_MSS_NC_MASTER_IDLE_ADDR A:0x1951008
y.create.l HWIO_TCSR_WCSS_HALTREQ_ADDR A:0x1952000
y.create.l HWIO_TCSR_WCSS_HALTACK_ADDR A:0x1952004
y.create.l HWIO_TCSR_WCSS_MASTER_IDLE_ADDR A:0x1952008
y.create.l HWIO_TCSR_SDC1_HALTREQ_ADDR A:0x1953000
y.create.l HWIO_TCSR_SDC1_HALTACK_ADDR A:0x1953004
y.create.l HWIO_TCSR_SDC1_MASTER_IDLE_ADDR A:0x1953008
y.create.l HWIO_TCSR_SDC2_HALTREQ_ADDR A:0x1954000
y.create.l HWIO_TCSR_SDC2_HALTACK_ADDR A:0x1954004
y.create.l HWIO_TCSR_SDC2_MASTER_IDLE_ADDR A:0x1954008
y.create.l HWIO_TCSR_ULT_AUDIO_CORE_ABORT_REQ_ADDR A:0x1955000
y.create.l HWIO_TCSR_ULT_AUDIO_CORE_ABORT_ACK_ADDR A:0x1955004
y.create.l HWIO_TCSR_TCSR_S1LM_APPS_TO_MODEM_INT_ADDR A:0x1956000
y.create.l HWIO_TCSR_TCSR_S1LM_APPS_TO_MODEM_INT_DATA_ADDR A:0x1956004
y.create.l HWIO_TCSR_SPARE_REG2_ADDR A:0x1956008
y.create.l HWIO_TCSR_SPARE_REG3_ADDR A:0x195600c
y.create.l HWIO_TCSR_PNOC_SNOC_MEMTYPE_ADDR A:0x1957000
y.create.l HWIO_CRYPTO0_CRYPTO_VERSION_ADDR A:0x73a000
y.create.l HWIO_CRYPTO0_CRYPTO_DATA_IN0_ADDR A:0x73a010
y.create.l HWIO_CRYPTO0_CRYPTO_DATA_IN1_ADDR A:0x73a014
y.create.l HWIO_CRYPTO0_CRYPTO_DATA_IN2_ADDR A:0x73a018
y.create.l HWIO_CRYPTO0_CRYPTO_DATA_IN3_ADDR A:0x73a01c
y.create.l HWIO_CRYPTO0_CRYPTO_DATA_OUT0_ADDR A:0x73a020
y.create.l HWIO_CRYPTO0_CRYPTO_DATA_OUT1_ADDR A:0x73a024
y.create.l HWIO_CRYPTO0_CRYPTO_DATA_OUT2_ADDR A:0x73a028
y.create.l HWIO_CRYPTO0_CRYPTO_DATA_OUT3_ADDR A:0x73a02c
y.create.l HWIO_CRYPTO0_CRYPTO_STATUS_ADDR A:0x73a100
y.create.l HWIO_CRYPTO0_CRYPTO_STATUS2_ADDR A:0x73a104
y.create.l HWIO_CRYPTO0_CRYPTO_BIST_STATUS_ADDR A:0x73a114
y.create.l HWIO_CRYPTO0_CRYPTO_BIST_FINISH_ADDR A:0x73a118
y.create.l HWIO_CRYPTO0_CRYPTO_ENGINES_AVAIL_ADDR A:0x73a108
y.create.l HWIO_CRYPTO0_CRYPTO_FIFO_SIZES_ADDR A:0x73a10c
y.create.l HWIO_CRYPTO0_CRYPTO_SEG_SIZE_ADDR A:0x73a110
y.create.l HWIO_CRYPTO0_CRYPTO_GOPROC_ADDR A:0x73a120
y.create.l HWIO_CRYPTO0_CRYPTO_GOPROC_QC_KEY_ADDR A:0x73b000
y.create.l HWIO_CRYPTO0_CRYPTO_GOPROC_OEM_KEY_ADDR A:0x73c000
y.create.l HWIO_CRYPTO0_CRYPTO_ENCR_SEG_CFG_ADDR A:0x73a200
y.create.l HWIO_CRYPTO0_CRYPTO_ENCR_SEG_SIZE_ADDR A:0x73a204
y.create.l HWIO_CRYPTO0_CRYPTO_ENCR_SEG_START_ADDR A:0x73a208
y.create.l HWIO_CRYPTO0_CRYPTO_ENCR_KEY0_ADDR A:0x73d000
y.create.l HWIO_CRYPTO0_CRYPTO_ENCR_KEY1_ADDR A:0x73d004
y.create.l HWIO_CRYPTO0_CRYPTO_ENCR_KEY2_ADDR A:0x73d008
y.create.l HWIO_CRYPTO0_CRYPTO_ENCR_KEY3_ADDR A:0x73d00c
y.create.l HWIO_CRYPTO0_CRYPTO_ENCR_KEY4_ADDR A:0x73d010
y.create.l HWIO_CRYPTO0_CRYPTO_ENCR_KEY5_ADDR A:0x73d014
y.create.l HWIO_CRYPTO0_CRYPTO_ENCR_KEY6_ADDR A:0x73d018
y.create.l HWIO_CRYPTO0_CRYPTO_ENCR_KEY7_ADDR A:0x73d01c
y.create.l HWIO_CRYPTO0_CRYPTO_ENCR_PIPE0_KEY0_ADDR A:0x73e000
y.create.l HWIO_CRYPTO0_CRYPTO_ENCR_PIPE0_KEY1_ADDR A:0x73e004
y.create.l HWIO_CRYPTO0_CRYPTO_ENCR_PIPE0_KEY2_ADDR A:0x73e008
y.create.l HWIO_CRYPTO0_CRYPTO_ENCR_PIPE0_KEY3_ADDR A:0x73e00c
y.create.l HWIO_CRYPTO0_CRYPTO_ENCR_PIPE1_KEY0_ADDR A:0x73e020
y.create.l HWIO_CRYPTO0_CRYPTO_ENCR_PIPE1_KEY1_ADDR A:0x73e024
y.create.l HWIO_CRYPTO0_CRYPTO_ENCR_PIPE1_KEY2_ADDR A:0x73e028
y.create.l HWIO_CRYPTO0_CRYPTO_ENCR_PIPE1_KEY3_ADDR A:0x73e02c
y.create.l HWIO_CRYPTO0_CRYPTO_ENCR_PIPE2_KEY0_ADDR A:0x73e040
y.create.l HWIO_CRYPTO0_CRYPTO_ENCR_PIPE2_KEY1_ADDR A:0x73e044
y.create.l HWIO_CRYPTO0_CRYPTO_ENCR_PIPE2_KEY2_ADDR A:0x73e048
y.create.l HWIO_CRYPTO0_CRYPTO_ENCR_PIPE2_KEY3_ADDR A:0x73e04c
y.create.l HWIO_CRYPTO0_CRYPTO_ENCR_PIPE3_KEY0_ADDR A:0x73e060
y.create.l HWIO_CRYPTO0_CRYPTO_ENCR_PIPE3_KEY1_ADDR A:0x73e064
y.create.l HWIO_CRYPTO0_CRYPTO_ENCR_PIPE3_KEY2_ADDR A:0x73e068
y.create.l HWIO_CRYPTO0_CRYPTO_ENCR_PIPE3_KEY3_ADDR A:0x73e06c
y.create.l HWIO_CRYPTO0_CRYPTO_ENCR_XTS_KEY0_ADDR A:0x73d020
y.create.l HWIO_CRYPTO0_CRYPTO_ENCR_XTS_KEY1_ADDR A:0x73d024
y.create.l HWIO_CRYPTO0_CRYPTO_ENCR_XTS_KEY2_ADDR A:0x73d028
y.create.l HWIO_CRYPTO0_CRYPTO_ENCR_XTS_KEY3_ADDR A:0x73d02c
y.create.l HWIO_CRYPTO0_CRYPTO_ENCR_XTS_KEY4_ADDR A:0x73d030
y.create.l HWIO_CRYPTO0_CRYPTO_ENCR_XTS_KEY5_ADDR A:0x73d034
y.create.l HWIO_CRYPTO0_CRYPTO_ENCR_XTS_KEY6_ADDR A:0x73d038
y.create.l HWIO_CRYPTO0_CRYPTO_ENCR_XTS_KEY7_ADDR A:0x73d03c
y.create.l HWIO_CRYPTO0_CRYPTO_ENCR_PIPE0_XTS_KEY0_ADDR A:0x73e200
y.create.l HWIO_CRYPTO0_CRYPTO_ENCR_PIPE0_XTS_KEY1_ADDR A:0x73e204
y.create.l HWIO_CRYPTO0_CRYPTO_ENCR_PIPE0_XTS_KEY2_ADDR A:0x73e208
y.create.l HWIO_CRYPTO0_CRYPTO_ENCR_PIPE0_XTS_KEY3_ADDR A:0x73e20c
y.create.l HWIO_CRYPTO0_CRYPTO_ENCR_PIPE1_XTS_KEY0_ADDR A:0x73e220
y.create.l HWIO_CRYPTO0_CRYPTO_ENCR_PIPE1_XTS_KEY1_ADDR A:0x73e224
y.create.l HWIO_CRYPTO0_CRYPTO_ENCR_PIPE1_XTS_KEY2_ADDR A:0x73e228
y.create.l HWIO_CRYPTO0_CRYPTO_ENCR_PIPE1_XTS_KEY3_ADDR A:0x73e22c
y.create.l HWIO_CRYPTO0_CRYPTO_ENCR_PIPE2_XTS_KEY0_ADDR A:0x73e240
y.create.l HWIO_CRYPTO0_CRYPTO_ENCR_PIPE2_XTS_KEY1_ADDR A:0x73e244
y.create.l HWIO_CRYPTO0_CRYPTO_ENCR_PIPE2_XTS_KEY2_ADDR A:0x73e248
y.create.l HWIO_CRYPTO0_CRYPTO_ENCR_PIPE2_XTS_KEY3_ADDR A:0x73e24c
y.create.l HWIO_CRYPTO0_CRYPTO_ENCR_PIPE3_XTS_KEY0_ADDR A:0x73e260
y.create.l HWIO_CRYPTO0_CRYPTO_ENCR_PIPE3_XTS_KEY1_ADDR A:0x73e264
y.create.l HWIO_CRYPTO0_CRYPTO_ENCR_PIPE3_XTS_KEY2_ADDR A:0x73e268
y.create.l HWIO_CRYPTO0_CRYPTO_ENCR_PIPE3_XTS_KEY3_ADDR A:0x73e26c
y.create.l HWIO_CRYPTO0_CRYPTO_ENCR_PIPE0_ODD_KEY0_ADDR A:0x73e400
y.create.l HWIO_CRYPTO0_CRYPTO_ENCR_PIPE0_ODD_KEY1_ADDR A:0x73e404
y.create.l HWIO_CRYPTO0_CRYPTO_ENCR_PIPE0_ODD_KEY2_ADDR A:0x73e408
y.create.l HWIO_CRYPTO0_CRYPTO_ENCR_PIPE0_ODD_KEY3_ADDR A:0x73e40c
y.create.l HWIO_CRYPTO0_CRYPTO_ENCR_PIPE1_ODD_KEY0_ADDR A:0x73e420
y.create.l HWIO_CRYPTO0_CRYPTO_ENCR_PIPE1_ODD_KEY1_ADDR A:0x73e424
y.create.l HWIO_CRYPTO0_CRYPTO_ENCR_PIPE1_ODD_KEY2_ADDR A:0x73e428
y.create.l HWIO_CRYPTO0_CRYPTO_ENCR_PIPE1_ODD_KEY3_ADDR A:0x73e42c
y.create.l HWIO_CRYPTO0_CRYPTO_ENCR_PIPE2_ODD_KEY0_ADDR A:0x73e440
y.create.l HWIO_CRYPTO0_CRYPTO_ENCR_PIPE2_ODD_KEY1_ADDR A:0x73e444
y.create.l HWIO_CRYPTO0_CRYPTO_ENCR_PIPE2_ODD_KEY2_ADDR A:0x73e448
y.create.l HWIO_CRYPTO0_CRYPTO_ENCR_PIPE2_ODD_KEY3_ADDR A:0x73e44c
y.create.l HWIO_CRYPTO0_CRYPTO_ENCR_PIPE3_ODD_KEY0_ADDR A:0x73e460
y.create.l HWIO_CRYPTO0_CRYPTO_ENCR_PIPE3_ODD_KEY1_ADDR A:0x73e464
y.create.l HWIO_CRYPTO0_CRYPTO_ENCR_PIPE3_ODD_KEY2_ADDR A:0x73e468
y.create.l HWIO_CRYPTO0_CRYPTO_ENCR_PIPE3_ODD_KEY3_ADDR A:0x73e46c
y.create.l HWIO_CRYPTO0_CRYPTO_ENCR_PIPE0_XTS_ODD_KEY0_ADDR A:0x73e600
y.create.l HWIO_CRYPTO0_CRYPTO_ENCR_PIPE0_XTS_ODD_KEY1_ADDR A:0x73e604
y.create.l HWIO_CRYPTO0_CRYPTO_ENCR_PIPE0_XTS_ODD_KEY2_ADDR A:0x73e608
y.create.l HWIO_CRYPTO0_CRYPTO_ENCR_PIPE0_XTS_ODD_KEY3_ADDR A:0x73e60c
y.create.l HWIO_CRYPTO0_CRYPTO_ENCR_PIPE1_XTS_ODD_KEY0_ADDR A:0x73e620
y.create.l HWIO_CRYPTO0_CRYPTO_ENCR_PIPE1_XTS_ODD_KEY1_ADDR A:0x73e624
y.create.l HWIO_CRYPTO0_CRYPTO_ENCR_PIPE1_XTS_ODD_KEY2_ADDR A:0x73e628
y.create.l HWIO_CRYPTO0_CRYPTO_ENCR_PIPE1_XTS_ODD_KEY3_ADDR A:0x73e62c
y.create.l HWIO_CRYPTO0_CRYPTO_ENCR_PIPE2_XTS_ODD_KEY0_ADDR A:0x73e640
y.create.l HWIO_CRYPTO0_CRYPTO_ENCR_PIPE2_XTS_ODD_KEY1_ADDR A:0x73e644
y.create.l HWIO_CRYPTO0_CRYPTO_ENCR_PIPE2_XTS_ODD_KEY2_ADDR A:0x73e648
y.create.l HWIO_CRYPTO0_CRYPTO_ENCR_PIPE2_XTS_ODD_KEY3_ADDR A:0x73e64c
y.create.l HWIO_CRYPTO0_CRYPTO_ENCR_PIPE3_XTS_ODD_KEY0_ADDR A:0x73e660
y.create.l HWIO_CRYPTO0_CRYPTO_ENCR_PIPE3_XTS_ODD_KEY1_ADDR A:0x73e664
y.create.l HWIO_CRYPTO0_CRYPTO_ENCR_PIPE3_XTS_ODD_KEY2_ADDR A:0x73e668
y.create.l HWIO_CRYPTO0_CRYPTO_ENCR_PIPE3_XTS_ODD_KEY3_ADDR A:0x73e66c
y.create.l HWIO_CRYPTO0_CRYPTO_ENCR_CNTR0_IV0_ADDR A:0x73a20c
y.create.l HWIO_CRYPTO0_CRYPTO_ENCR_CNTR1_IV1_ADDR A:0x73a210
y.create.l HWIO_CRYPTO0_CRYPTO_ENCR_CNTR2_IV2_ADDR A:0x73a214
y.create.l HWIO_CRYPTO0_CRYPTO_ENCR_CNTR3_IV3_ADDR A:0x73a218
y.create.l HWIO_CRYPTO0_CRYPTO_ENCR_CNTR_MASK_ADDR A:0x73a21c
y.create.l HWIO_CRYPTO0_CRYPTO_ENCR_CNTR_MASK2_ADDR A:0x73a234
y.create.l HWIO_CRYPTO0_CRYPTO_ENCR_CNTR_MASK1_ADDR A:0x73a238
y.create.l HWIO_CRYPTO0_CRYPTO_ENCR_CNTR_MASK0_ADDR A:0x73a23c
y.create.l HWIO_CRYPTO0_CRYPTO_ENCR_CCM_INIT_CNTR0_ADDR A:0x73a220
y.create.l HWIO_CRYPTO0_CRYPTO_ENCR_CCM_INIT_CNTR1_ADDR A:0x73a224
y.create.l HWIO_CRYPTO0_CRYPTO_ENCR_CCM_INIT_CNTR2_ADDR A:0x73a228
y.create.l HWIO_CRYPTO0_CRYPTO_ENCR_CCM_INIT_CNTR3_ADDR A:0x73a22c
y.create.l HWIO_CRYPTO0_CRYPTO_ENCR_XTS_DU_SIZE_ADDR A:0x73a230
y.create.l HWIO_CRYPTO0_CRYPTO_AUTH_SEG_CFG_ADDR A:0x73a300
y.create.l HWIO_CRYPTO0_CRYPTO_AUTH_SEG_SIZE_ADDR A:0x73a304
y.create.l HWIO_CRYPTO0_CRYPTO_AUTH_SEG_START_ADDR A:0x73a308
y.create.l HWIO_CRYPTO0_CRYPTO_AUTH_KEY0_ADDR A:0x73d040
y.create.l HWIO_CRYPTO0_CRYPTO_AUTH_KEY1_ADDR A:0x73d044
y.create.l HWIO_CRYPTO0_CRYPTO_AUTH_KEY2_ADDR A:0x73d048
y.create.l HWIO_CRYPTO0_CRYPTO_AUTH_KEY3_ADDR A:0x73d04c
y.create.l HWIO_CRYPTO0_CRYPTO_AUTH_KEY4_ADDR A:0x73d050
y.create.l HWIO_CRYPTO0_CRYPTO_AUTH_KEY5_ADDR A:0x73d054
y.create.l HWIO_CRYPTO0_CRYPTO_AUTH_KEY6_ADDR A:0x73d058
y.create.l HWIO_CRYPTO0_CRYPTO_AUTH_KEY7_ADDR A:0x73d05c
y.create.l HWIO_CRYPTO0_CRYPTO_AUTH_KEY8_ADDR A:0x73d060
y.create.l HWIO_CRYPTO0_CRYPTO_AUTH_KEY9_ADDR A:0x73d064
y.create.l HWIO_CRYPTO0_CRYPTO_AUTH_PIPE0_KEY0_ADDR A:0x73e800
y.create.l HWIO_CRYPTO0_CRYPTO_AUTH_PIPE0_KEY1_ADDR A:0x73e804
y.create.l HWIO_CRYPTO0_CRYPTO_AUTH_PIPE0_KEY2_ADDR A:0x73e808
y.create.l HWIO_CRYPTO0_CRYPTO_AUTH_PIPE0_KEY3_ADDR A:0x73e80c
y.create.l HWIO_CRYPTO0_CRYPTO_AUTH_PIPE1_KEY0_ADDR A:0x73e880
y.create.l HWIO_CRYPTO0_CRYPTO_AUTH_PIPE1_KEY1_ADDR A:0x73e884
y.create.l HWIO_CRYPTO0_CRYPTO_AUTH_PIPE1_KEY2_ADDR A:0x73e888
y.create.l HWIO_CRYPTO0_CRYPTO_AUTH_PIPE1_KEY3_ADDR A:0x73e88c
y.create.l HWIO_CRYPTO0_CRYPTO_AUTH_PIPE2_KEY0_ADDR A:0x73e900
y.create.l HWIO_CRYPTO0_CRYPTO_AUTH_PIPE2_KEY1_ADDR A:0x73e904
y.create.l HWIO_CRYPTO0_CRYPTO_AUTH_PIPE2_KEY2_ADDR A:0x73e908
y.create.l HWIO_CRYPTO0_CRYPTO_AUTH_PIPE2_KEY3_ADDR A:0x73e90c
y.create.l HWIO_CRYPTO0_CRYPTO_AUTH_PIPE3_KEY0_ADDR A:0x73e980
y.create.l HWIO_CRYPTO0_CRYPTO_AUTH_PIPE3_KEY1_ADDR A:0x73e984
y.create.l HWIO_CRYPTO0_CRYPTO_AUTH_PIPE3_KEY2_ADDR A:0x73e988
y.create.l HWIO_CRYPTO0_CRYPTO_AUTH_PIPE3_KEY3_ADDR A:0x73e98c
y.create.l HWIO_CRYPTO0_CRYPTO_AUTH_IV0_ADDR A:0x73a310
y.create.l HWIO_CRYPTO0_CRYPTO_AUTH_IV1_ADDR A:0x73a314
y.create.l HWIO_CRYPTO0_CRYPTO_AUTH_IV2_ADDR A:0x73a318
y.create.l HWIO_CRYPTO0_CRYPTO_AUTH_IV3_ADDR A:0x73a31c
y.create.l HWIO_CRYPTO0_CRYPTO_AUTH_IV4_ADDR A:0x73a320
y.create.l HWIO_CRYPTO0_CRYPTO_AUTH_IV5_ADDR A:0x73a324
y.create.l HWIO_CRYPTO0_CRYPTO_AUTH_IV6_ADDR A:0x73a328
y.create.l HWIO_CRYPTO0_CRYPTO_AUTH_IV7_ADDR A:0x73a32c
y.create.l HWIO_CRYPTO0_CRYPTO_AUTH_INFO_NONCE0_ADDR A:0x73a350
y.create.l HWIO_CRYPTO0_CRYPTO_AUTH_INFO_NONCE1_ADDR A:0x73a354
y.create.l HWIO_CRYPTO0_CRYPTO_AUTH_INFO_NONCE2_ADDR A:0x73a358
y.create.l HWIO_CRYPTO0_CRYPTO_AUTH_INFO_NONCE3_ADDR A:0x73a35c
y.create.l HWIO_CRYPTO0_CRYPTO_AUTH_BYTECNT0_ADDR A:0x73a390
y.create.l HWIO_CRYPTO0_CRYPTO_AUTH_BYTECNT1_ADDR A:0x73a394
y.create.l HWIO_CRYPTO0_CRYPTO_AUTH_EXP_MAC0_ADDR A:0x73a3a0
y.create.l HWIO_CRYPTO0_CRYPTO_AUTH_EXP_MAC1_ADDR A:0x73a3a4
y.create.l HWIO_CRYPTO0_CRYPTO_AUTH_EXP_MAC2_ADDR A:0x73a3a8
y.create.l HWIO_CRYPTO0_CRYPTO_AUTH_EXP_MAC3_ADDR A:0x73a3ac
y.create.l HWIO_CRYPTO0_CRYPTO_AUTH_EXP_MAC4_ADDR A:0x73a3b0
y.create.l HWIO_CRYPTO0_CRYPTO_AUTH_EXP_MAC5_ADDR A:0x73a3b4
y.create.l HWIO_CRYPTO0_CRYPTO_AUTH_EXP_MAC6_ADDR A:0x73a3b8
y.create.l HWIO_CRYPTO0_CRYPTO_AUTH_EXP_MAC7_ADDR A:0x73a3bc
y.create.l HWIO_CRYPTO0_CRYPTO_CONFIG_ADDR A:0x73a400
y.create.l HWIO_CRYPTO0_CRYPTO_DEBUG_ENABLE_ADDR A:0x73f000
y.create.l HWIO_CRYPTO0_CRYPTO_DEBUG_ADDR A:0x73f004
y.create.l HWIO_CRYPTO0_CRYPTO_PWR_CTRL_ADDR A:0x73f008
y.create.l HWIO_CRYPTO0_CRYPTO_BAM_CTRL_ADDR A:0x704000
y.create.l HWIO_CRYPTO0_CRYPTO_BAM_TIMER_ADDR A:0x704040
y.create.l HWIO_CRYPTO0_CRYPTO_BAM_TIMER_CTRL_ADDR A:0x704044
y.create.l HWIO_CRYPTO0_CRYPTO_BAM_DESC_CNT_TRSHLD_ADDR A:0x704008
y.create.l HWIO_CRYPTO0_CRYPTO_BAM_IRQ_STTS_ADDR A:0x704014
y.create.l HWIO_CRYPTO0_CRYPTO_BAM_IRQ_CLR_ADDR A:0x704018
y.create.l HWIO_CRYPTO0_CRYPTO_BAM_IRQ_EN_ADDR A:0x70401c
y.create.l HWIO_CRYPTO0_CRYPTO_BAM_CNFG_BITS_ADDR A:0x70407c
y.create.l HWIO_CRYPTO0_CRYPTO_BAM_CNFG_BITS_2_ADDR A:0x704084
y.create.l HWIO_CRYPTO0_CRYPTO_BAM_REVISION_ADDR A:0x705000
y.create.l HWIO_CRYPTO0_CRYPTO_BAM_SW_VERSION_ADDR A:0x705004
y.create.l HWIO_CRYPTO0_CRYPTO_BAM_NUM_PIPES_ADDR A:0x705008
y.create.l HWIO_CRYPTO0_CRYPTO_BAM_TEST_BUS_SEL_ADDR A:0x705010
y.create.l HWIO_CRYPTO0_CRYPTO_BAM_TEST_BUS_REG_ADDR A:0x705014
y.create.l HWIO_CRYPTO0_CRYPTO_BAM_AHB_MASTER_ERR_CTRLS_ADDR A:0x705024
y.create.l HWIO_CRYPTO0_CRYPTO_BAM_AHB_MASTER_ERR_ADDR_ADDR A:0x705028
y.create.l HWIO_CRYPTO0_CRYPTO_BAM_AHB_MASTER_ERR_DATA_ADDR A:0x70502c
y.create.l HWIO_CRYPTO0_CRYPTO_BAM_AHB_MASTER_ERR_ADDR_LSB_ADDR A:0x705100
y.create.l HWIO_CRYPTO0_CRYPTO_BAM_AHB_MASTER_ERR_ADDR_MSB_ADDR A:0x705104
y.create.l HWIO_CRYPTO0_CRYPTO_BAM_TRUST_REG_ADDR A:0x706000
y.create.l HWIO_CRYPTO0_CRYPTO_BAM_P_TRUST_REG0_ADDR A:0x706020
y.create.l HWIO_CRYPTO0_CRYPTO_BAM_P_TRUST_REG1_ADDR A:0x706024
y.create.l HWIO_CRYPTO0_CRYPTO_BAM_P_TRUST_REG2_ADDR A:0x706028
y.create.l HWIO_CRYPTO0_CRYPTO_BAM_P_TRUST_REG3_ADDR A:0x70602c
y.create.l HWIO_CRYPTO0_CRYPTO_BAM_P_TRUST_REG4_ADDR A:0x706030
y.create.l HWIO_CRYPTO0_CRYPTO_BAM_P_TRUST_REG5_ADDR A:0x706034
y.create.l HWIO_CRYPTO0_CRYPTO_BAM_P_TRUST_REG6_ADDR A:0x706038
y.create.l HWIO_CRYPTO0_CRYPTO_BAM_P_TRUST_REG7_ADDR A:0x70603c
y.create.l HWIO_CRYPTO0_CRYPTO_BAM_IRQ_SRCS_EE0_ADDR A:0x707000
y.create.l HWIO_CRYPTO0_CRYPTO_BAM_IRQ_SRCS_EE1_ADDR A:0x708000
y.create.l HWIO_CRYPTO0_CRYPTO_BAM_IRQ_SRCS_EE2_ADDR A:0x709000
y.create.l HWIO_CRYPTO0_CRYPTO_BAM_IRQ_SRCS_EE3_ADDR A:0x70a000
y.create.l HWIO_CRYPTO0_CRYPTO_BAM_IRQ_SRCS_EE4_ADDR A:0x70b000
y.create.l HWIO_CRYPTO0_CRYPTO_BAM_IRQ_SRCS_EE5_ADDR A:0x70c000
y.create.l HWIO_CRYPTO0_CRYPTO_BAM_IRQ_SRCS_EE6_ADDR A:0x70d000
y.create.l HWIO_CRYPTO0_CRYPTO_BAM_IRQ_SRCS_EE7_ADDR A:0x70e000
y.create.l HWIO_CRYPTO0_CRYPTO_BAM_IRQ_SRCS_MSK_EE0_ADDR A:0x707004
y.create.l HWIO_CRYPTO0_CRYPTO_BAM_IRQ_SRCS_MSK_EE1_ADDR A:0x708004
y.create.l HWIO_CRYPTO0_CRYPTO_BAM_IRQ_SRCS_MSK_EE2_ADDR A:0x709004
y.create.l HWIO_CRYPTO0_CRYPTO_BAM_IRQ_SRCS_MSK_EE3_ADDR A:0x70a004
y.create.l HWIO_CRYPTO0_CRYPTO_BAM_IRQ_SRCS_MSK_EE4_ADDR A:0x70b004
y.create.l HWIO_CRYPTO0_CRYPTO_BAM_IRQ_SRCS_MSK_EE5_ADDR A:0x70c004
y.create.l HWIO_CRYPTO0_CRYPTO_BAM_IRQ_SRCS_MSK_EE6_ADDR A:0x70d004
y.create.l HWIO_CRYPTO0_CRYPTO_BAM_IRQ_SRCS_MSK_EE7_ADDR A:0x70e004
y.create.l HWIO_CRYPTO0_CRYPTO_BAM_IRQ_SRCS_UNMASKED_EE0_ADDR A:0x707008
y.create.l HWIO_CRYPTO0_CRYPTO_BAM_IRQ_SRCS_UNMASKED_EE1_ADDR A:0x708008
y.create.l HWIO_CRYPTO0_CRYPTO_BAM_IRQ_SRCS_UNMASKED_EE2_ADDR A:0x709008
y.create.l HWIO_CRYPTO0_CRYPTO_BAM_IRQ_SRCS_UNMASKED_EE3_ADDR A:0x70a008
y.create.l HWIO_CRYPTO0_CRYPTO_BAM_IRQ_SRCS_UNMASKED_EE4_ADDR A:0x70b008
y.create.l HWIO_CRYPTO0_CRYPTO_BAM_IRQ_SRCS_UNMASKED_EE5_ADDR A:0x70c008
y.create.l HWIO_CRYPTO0_CRYPTO_BAM_IRQ_SRCS_UNMASKED_EE6_ADDR A:0x70d008
y.create.l HWIO_CRYPTO0_CRYPTO_BAM_IRQ_SRCS_UNMASKED_EE7_ADDR A:0x70e008
y.create.l HWIO_CRYPTO0_CRYPTO_BAM_PIPE_ATTR_EE0_ADDR A:0x70700c
y.create.l HWIO_CRYPTO0_CRYPTO_BAM_PIPE_ATTR_EE1_ADDR A:0x70800c
y.create.l HWIO_CRYPTO0_CRYPTO_BAM_PIPE_ATTR_EE2_ADDR A:0x70900c
y.create.l HWIO_CRYPTO0_CRYPTO_BAM_PIPE_ATTR_EE3_ADDR A:0x70a00c
y.create.l HWIO_CRYPTO0_CRYPTO_BAM_PIPE_ATTR_EE4_ADDR A:0x70b00c
y.create.l HWIO_CRYPTO0_CRYPTO_BAM_PIPE_ATTR_EE5_ADDR A:0x70c00c
y.create.l HWIO_CRYPTO0_CRYPTO_BAM_PIPE_ATTR_EE6_ADDR A:0x70d00c
y.create.l HWIO_CRYPTO0_CRYPTO_BAM_PIPE_ATTR_EE7_ADDR A:0x70e00c
y.create.l HWIO_CRYPTO0_CRYPTO_BAM_IRQ_SRCS_ADDR A:0x707010
y.create.l HWIO_CRYPTO0_CRYPTO_BAM_IRQ_SRCS_MSK_ADDR A:0x707014
y.create.l HWIO_CRYPTO0_CRYPTO_BAM_IRQ_SRCS_UNMASKED_ADDR A:0x707018
y.create.l HWIO_CRYPTO0_CRYPTO_BAM_P_CTRL0_ADDR A:0x717000
y.create.l HWIO_CRYPTO0_CRYPTO_BAM_P_CTRL1_ADDR A:0x718000
y.create.l HWIO_CRYPTO0_CRYPTO_BAM_P_CTRL2_ADDR A:0x719000
y.create.l HWIO_CRYPTO0_CRYPTO_BAM_P_CTRL3_ADDR A:0x71a000
y.create.l HWIO_CRYPTO0_CRYPTO_BAM_P_CTRL4_ADDR A:0x71b000
y.create.l HWIO_CRYPTO0_CRYPTO_BAM_P_CTRL5_ADDR A:0x71c000
y.create.l HWIO_CRYPTO0_CRYPTO_BAM_P_CTRL6_ADDR A:0x71d000
y.create.l HWIO_CRYPTO0_CRYPTO_BAM_P_CTRL7_ADDR A:0x71e000
y.create.l HWIO_CRYPTO0_CRYPTO_BAM_P_RST0_ADDR A:0x717004
y.create.l HWIO_CRYPTO0_CRYPTO_BAM_P_RST1_ADDR A:0x718004
y.create.l HWIO_CRYPTO0_CRYPTO_BAM_P_RST2_ADDR A:0x719004
y.create.l HWIO_CRYPTO0_CRYPTO_BAM_P_RST3_ADDR A:0x71a004
y.create.l HWIO_CRYPTO0_CRYPTO_BAM_P_RST4_ADDR A:0x71b004
y.create.l HWIO_CRYPTO0_CRYPTO_BAM_P_RST5_ADDR A:0x71c004
y.create.l HWIO_CRYPTO0_CRYPTO_BAM_P_RST6_ADDR A:0x71d004
y.create.l HWIO_CRYPTO0_CRYPTO_BAM_P_RST7_ADDR A:0x71e004
y.create.l HWIO_CRYPTO0_CRYPTO_BAM_P_HALT0_ADDR A:0x717008
y.create.l HWIO_CRYPTO0_CRYPTO_BAM_P_HALT1_ADDR A:0x718008
y.create.l HWIO_CRYPTO0_CRYPTO_BAM_P_HALT2_ADDR A:0x719008
y.create.l HWIO_CRYPTO0_CRYPTO_BAM_P_HALT3_ADDR A:0x71a008
y.create.l HWIO_CRYPTO0_CRYPTO_BAM_P_HALT4_ADDR A:0x71b008
y.create.l HWIO_CRYPTO0_CRYPTO_BAM_P_HALT5_ADDR A:0x71c008
y.create.l HWIO_CRYPTO0_CRYPTO_BAM_P_HALT6_ADDR A:0x71d008
y.create.l HWIO_CRYPTO0_CRYPTO_BAM_P_HALT7_ADDR A:0x71e008
y.create.l HWIO_CRYPTO0_CRYPTO_BAM_P_IRQ_STTS0_ADDR A:0x717010
y.create.l HWIO_CRYPTO0_CRYPTO_BAM_P_IRQ_STTS1_ADDR A:0x718010
y.create.l HWIO_CRYPTO0_CRYPTO_BAM_P_IRQ_STTS2_ADDR A:0x719010
y.create.l HWIO_CRYPTO0_CRYPTO_BAM_P_IRQ_STTS3_ADDR A:0x71a010
y.create.l HWIO_CRYPTO0_CRYPTO_BAM_P_IRQ_STTS4_ADDR A:0x71b010
y.create.l HWIO_CRYPTO0_CRYPTO_BAM_P_IRQ_STTS5_ADDR A:0x71c010
y.create.l HWIO_CRYPTO0_CRYPTO_BAM_P_IRQ_STTS6_ADDR A:0x71d010
y.create.l HWIO_CRYPTO0_CRYPTO_BAM_P_IRQ_STTS7_ADDR A:0x71e010
y.create.l HWIO_CRYPTO0_CRYPTO_BAM_P_IRQ_CLR0_ADDR A:0x717014
y.create.l HWIO_CRYPTO0_CRYPTO_BAM_P_IRQ_CLR1_ADDR A:0x718014
y.create.l HWIO_CRYPTO0_CRYPTO_BAM_P_IRQ_CLR2_ADDR A:0x719014
y.create.l HWIO_CRYPTO0_CRYPTO_BAM_P_IRQ_CLR3_ADDR A:0x71a014
y.create.l HWIO_CRYPTO0_CRYPTO_BAM_P_IRQ_CLR4_ADDR A:0x71b014
y.create.l HWIO_CRYPTO0_CRYPTO_BAM_P_IRQ_CLR5_ADDR A:0x71c014
y.create.l HWIO_CRYPTO0_CRYPTO_BAM_P_IRQ_CLR6_ADDR A:0x71d014
y.create.l HWIO_CRYPTO0_CRYPTO_BAM_P_IRQ_CLR7_ADDR A:0x71e014
y.create.l HWIO_CRYPTO0_CRYPTO_BAM_P_IRQ_EN0_ADDR A:0x717018
y.create.l HWIO_CRYPTO0_CRYPTO_BAM_P_IRQ_EN1_ADDR A:0x718018
y.create.l HWIO_CRYPTO0_CRYPTO_BAM_P_IRQ_EN2_ADDR A:0x719018
y.create.l HWIO_CRYPTO0_CRYPTO_BAM_P_IRQ_EN3_ADDR A:0x71a018
y.create.l HWIO_CRYPTO0_CRYPTO_BAM_P_IRQ_EN4_ADDR A:0x71b018
y.create.l HWIO_CRYPTO0_CRYPTO_BAM_P_IRQ_EN5_ADDR A:0x71c018
y.create.l HWIO_CRYPTO0_CRYPTO_BAM_P_IRQ_EN6_ADDR A:0x71d018
y.create.l HWIO_CRYPTO0_CRYPTO_BAM_P_IRQ_EN7_ADDR A:0x71e018
y.create.l HWIO_CRYPTO0_CRYPTO_BAM_P_TIMER0_ADDR A:0x71701c
y.create.l HWIO_CRYPTO0_CRYPTO_BAM_P_TIMER1_ADDR A:0x71801c
y.create.l HWIO_CRYPTO0_CRYPTO_BAM_P_TIMER2_ADDR A:0x71901c
y.create.l HWIO_CRYPTO0_CRYPTO_BAM_P_TIMER3_ADDR A:0x71a01c
y.create.l HWIO_CRYPTO0_CRYPTO_BAM_P_TIMER4_ADDR A:0x71b01c
y.create.l HWIO_CRYPTO0_CRYPTO_BAM_P_TIMER5_ADDR A:0x71c01c
y.create.l HWIO_CRYPTO0_CRYPTO_BAM_P_TIMER6_ADDR A:0x71d01c
y.create.l HWIO_CRYPTO0_CRYPTO_BAM_P_TIMER7_ADDR A:0x71e01c
y.create.l HWIO_CRYPTO0_CRYPTO_BAM_P_TIMER_CTRL0_ADDR A:0x717020
y.create.l HWIO_CRYPTO0_CRYPTO_BAM_P_TIMER_CTRL1_ADDR A:0x718020
y.create.l HWIO_CRYPTO0_CRYPTO_BAM_P_TIMER_CTRL2_ADDR A:0x719020
y.create.l HWIO_CRYPTO0_CRYPTO_BAM_P_TIMER_CTRL3_ADDR A:0x71a020
y.create.l HWIO_CRYPTO0_CRYPTO_BAM_P_TIMER_CTRL4_ADDR A:0x71b020
y.create.l HWIO_CRYPTO0_CRYPTO_BAM_P_TIMER_CTRL5_ADDR A:0x71c020
y.create.l HWIO_CRYPTO0_CRYPTO_BAM_P_TIMER_CTRL6_ADDR A:0x71d020
y.create.l HWIO_CRYPTO0_CRYPTO_BAM_P_TIMER_CTRL7_ADDR A:0x71e020
y.create.l HWIO_CRYPTO0_CRYPTO_BAM_P_PRDCR_SDBND0_ADDR A:0x717024
y.create.l HWIO_CRYPTO0_CRYPTO_BAM_P_PRDCR_SDBND1_ADDR A:0x718024
y.create.l HWIO_CRYPTO0_CRYPTO_BAM_P_PRDCR_SDBND2_ADDR A:0x719024
y.create.l HWIO_CRYPTO0_CRYPTO_BAM_P_PRDCR_SDBND3_ADDR A:0x71a024
y.create.l HWIO_CRYPTO0_CRYPTO_BAM_P_PRDCR_SDBND4_ADDR A:0x71b024
y.create.l HWIO_CRYPTO0_CRYPTO_BAM_P_PRDCR_SDBND5_ADDR A:0x71c024
y.create.l HWIO_CRYPTO0_CRYPTO_BAM_P_PRDCR_SDBND6_ADDR A:0x71d024
y.create.l HWIO_CRYPTO0_CRYPTO_BAM_P_PRDCR_SDBND7_ADDR A:0x71e024
y.create.l HWIO_CRYPTO0_CRYPTO_BAM_P_CNSMR_SDBND0_ADDR A:0x717028
y.create.l HWIO_CRYPTO0_CRYPTO_BAM_P_CNSMR_SDBND1_ADDR A:0x718028
y.create.l HWIO_CRYPTO0_CRYPTO_BAM_P_CNSMR_SDBND2_ADDR A:0x719028
y.create.l HWIO_CRYPTO0_CRYPTO_BAM_P_CNSMR_SDBND3_ADDR A:0x71a028
y.create.l HWIO_CRYPTO0_CRYPTO_BAM_P_CNSMR_SDBND4_ADDR A:0x71b028
y.create.l HWIO_CRYPTO0_CRYPTO_BAM_P_CNSMR_SDBND5_ADDR A:0x71c028
y.create.l HWIO_CRYPTO0_CRYPTO_BAM_P_CNSMR_SDBND6_ADDR A:0x71d028
y.create.l HWIO_CRYPTO0_CRYPTO_BAM_P_CNSMR_SDBND7_ADDR A:0x71e028
y.create.l HWIO_CRYPTO0_CRYPTO_BAM_P_SW_OFSTS0_ADDR A:0x717800
y.create.l HWIO_CRYPTO0_CRYPTO_BAM_P_SW_OFSTS1_ADDR A:0x718800
y.create.l HWIO_CRYPTO0_CRYPTO_BAM_P_SW_OFSTS2_ADDR A:0x719800
y.create.l HWIO_CRYPTO0_CRYPTO_BAM_P_SW_OFSTS3_ADDR A:0x71a800
y.create.l HWIO_CRYPTO0_CRYPTO_BAM_P_SW_OFSTS4_ADDR A:0x71b800
y.create.l HWIO_CRYPTO0_CRYPTO_BAM_P_SW_OFSTS5_ADDR A:0x71c800
y.create.l HWIO_CRYPTO0_CRYPTO_BAM_P_SW_OFSTS6_ADDR A:0x71d800
y.create.l HWIO_CRYPTO0_CRYPTO_BAM_P_SW_OFSTS7_ADDR A:0x71e800
y.create.l HWIO_CRYPTO0_CRYPTO_BAM_P_AU_PSM_CNTXT_1_0_ADDR A:0x717804
y.create.l HWIO_CRYPTO0_CRYPTO_BAM_P_AU_PSM_CNTXT_1_1_ADDR A:0x718804
y.create.l HWIO_CRYPTO0_CRYPTO_BAM_P_AU_PSM_CNTXT_1_2_ADDR A:0x719804
y.create.l HWIO_CRYPTO0_CRYPTO_BAM_P_AU_PSM_CNTXT_1_3_ADDR A:0x71a804
y.create.l HWIO_CRYPTO0_CRYPTO_BAM_P_AU_PSM_CNTXT_1_4_ADDR A:0x71b804
y.create.l HWIO_CRYPTO0_CRYPTO_BAM_P_AU_PSM_CNTXT_1_5_ADDR A:0x71c804
y.create.l HWIO_CRYPTO0_CRYPTO_BAM_P_AU_PSM_CNTXT_1_6_ADDR A:0x71d804
y.create.l HWIO_CRYPTO0_CRYPTO_BAM_P_AU_PSM_CNTXT_1_7_ADDR A:0x71e804
y.create.l HWIO_CRYPTO0_CRYPTO_BAM_P_PSM_CNTXT_2_0_ADDR A:0x717808
y.create.l HWIO_CRYPTO0_CRYPTO_BAM_P_PSM_CNTXT_2_1_ADDR A:0x718808
y.create.l HWIO_CRYPTO0_CRYPTO_BAM_P_PSM_CNTXT_2_2_ADDR A:0x719808
y.create.l HWIO_CRYPTO0_CRYPTO_BAM_P_PSM_CNTXT_2_3_ADDR A:0x71a808
y.create.l HWIO_CRYPTO0_CRYPTO_BAM_P_PSM_CNTXT_2_4_ADDR A:0x71b808
y.create.l HWIO_CRYPTO0_CRYPTO_BAM_P_PSM_CNTXT_2_5_ADDR A:0x71c808
y.create.l HWIO_CRYPTO0_CRYPTO_BAM_P_PSM_CNTXT_2_6_ADDR A:0x71d808
y.create.l HWIO_CRYPTO0_CRYPTO_BAM_P_PSM_CNTXT_2_7_ADDR A:0x71e808
y.create.l HWIO_CRYPTO0_CRYPTO_BAM_P_PSM_CNTXT_3_0_ADDR A:0x71780c
y.create.l HWIO_CRYPTO0_CRYPTO_BAM_P_PSM_CNTXT_3_1_ADDR A:0x71880c
y.create.l HWIO_CRYPTO0_CRYPTO_BAM_P_PSM_CNTXT_3_2_ADDR A:0x71980c
y.create.l HWIO_CRYPTO0_CRYPTO_BAM_P_PSM_CNTXT_3_3_ADDR A:0x71a80c
y.create.l HWIO_CRYPTO0_CRYPTO_BAM_P_PSM_CNTXT_3_4_ADDR A:0x71b80c
y.create.l HWIO_CRYPTO0_CRYPTO_BAM_P_PSM_CNTXT_3_5_ADDR A:0x71c80c
y.create.l HWIO_CRYPTO0_CRYPTO_BAM_P_PSM_CNTXT_3_6_ADDR A:0x71d80c
y.create.l HWIO_CRYPTO0_CRYPTO_BAM_P_PSM_CNTXT_3_7_ADDR A:0x71e80c
y.create.l HWIO_CRYPTO0_CRYPTO_BAM_P_PSM_CNTXT_4_0_ADDR A:0x717810
y.create.l HWIO_CRYPTO0_CRYPTO_BAM_P_PSM_CNTXT_4_1_ADDR A:0x718810
y.create.l HWIO_CRYPTO0_CRYPTO_BAM_P_PSM_CNTXT_4_2_ADDR A:0x719810
y.create.l HWIO_CRYPTO0_CRYPTO_BAM_P_PSM_CNTXT_4_3_ADDR A:0x71a810
y.create.l HWIO_CRYPTO0_CRYPTO_BAM_P_PSM_CNTXT_4_4_ADDR A:0x71b810
y.create.l HWIO_CRYPTO0_CRYPTO_BAM_P_PSM_CNTXT_4_5_ADDR A:0x71c810
y.create.l HWIO_CRYPTO0_CRYPTO_BAM_P_PSM_CNTXT_4_6_ADDR A:0x71d810
y.create.l HWIO_CRYPTO0_CRYPTO_BAM_P_PSM_CNTXT_4_7_ADDR A:0x71e810
y.create.l HWIO_CRYPTO0_CRYPTO_BAM_P_PSM_CNTXT_5_0_ADDR A:0x717814
y.create.l HWIO_CRYPTO0_CRYPTO_BAM_P_PSM_CNTXT_5_1_ADDR A:0x718814
y.create.l HWIO_CRYPTO0_CRYPTO_BAM_P_PSM_CNTXT_5_2_ADDR A:0x719814
y.create.l HWIO_CRYPTO0_CRYPTO_BAM_P_PSM_CNTXT_5_3_ADDR A:0x71a814
y.create.l HWIO_CRYPTO0_CRYPTO_BAM_P_PSM_CNTXT_5_4_ADDR A:0x71b814
y.create.l HWIO_CRYPTO0_CRYPTO_BAM_P_PSM_CNTXT_5_5_ADDR A:0x71c814
y.create.l HWIO_CRYPTO0_CRYPTO_BAM_P_PSM_CNTXT_5_6_ADDR A:0x71d814
y.create.l HWIO_CRYPTO0_CRYPTO_BAM_P_PSM_CNTXT_5_7_ADDR A:0x71e814
y.create.l HWIO_CRYPTO0_CRYPTO_BAM_P_EVNT_REG0_ADDR A:0x717818
y.create.l HWIO_CRYPTO0_CRYPTO_BAM_P_EVNT_REG1_ADDR A:0x718818
y.create.l HWIO_CRYPTO0_CRYPTO_BAM_P_EVNT_REG2_ADDR A:0x719818
y.create.l HWIO_CRYPTO0_CRYPTO_BAM_P_EVNT_REG3_ADDR A:0x71a818
y.create.l HWIO_CRYPTO0_CRYPTO_BAM_P_EVNT_REG4_ADDR A:0x71b818
y.create.l HWIO_CRYPTO0_CRYPTO_BAM_P_EVNT_REG5_ADDR A:0x71c818
y.create.l HWIO_CRYPTO0_CRYPTO_BAM_P_EVNT_REG6_ADDR A:0x71d818
y.create.l HWIO_CRYPTO0_CRYPTO_BAM_P_EVNT_REG7_ADDR A:0x71e818
y.create.l HWIO_CRYPTO0_CRYPTO_BAM_P_DESC_FIFO_ADDR0_ADDR A:0x71781c
y.create.l HWIO_CRYPTO0_CRYPTO_BAM_P_DESC_FIFO_ADDR1_ADDR A:0x71881c
y.create.l HWIO_CRYPTO0_CRYPTO_BAM_P_DESC_FIFO_ADDR2_ADDR A:0x71981c
y.create.l HWIO_CRYPTO0_CRYPTO_BAM_P_DESC_FIFO_ADDR3_ADDR A:0x71a81c
y.create.l HWIO_CRYPTO0_CRYPTO_BAM_P_DESC_FIFO_ADDR4_ADDR A:0x71b81c
y.create.l HWIO_CRYPTO0_CRYPTO_BAM_P_DESC_FIFO_ADDR5_ADDR A:0x71c81c
y.create.l HWIO_CRYPTO0_CRYPTO_BAM_P_DESC_FIFO_ADDR6_ADDR A:0x71d81c
y.create.l HWIO_CRYPTO0_CRYPTO_BAM_P_DESC_FIFO_ADDR7_ADDR A:0x71e81c
y.create.l HWIO_CRYPTO0_CRYPTO_BAM_P_FIFO_SIZES0_ADDR A:0x717820
y.create.l HWIO_CRYPTO0_CRYPTO_BAM_P_FIFO_SIZES1_ADDR A:0x718820
y.create.l HWIO_CRYPTO0_CRYPTO_BAM_P_FIFO_SIZES2_ADDR A:0x719820
y.create.l HWIO_CRYPTO0_CRYPTO_BAM_P_FIFO_SIZES3_ADDR A:0x71a820
y.create.l HWIO_CRYPTO0_CRYPTO_BAM_P_FIFO_SIZES4_ADDR A:0x71b820
y.create.l HWIO_CRYPTO0_CRYPTO_BAM_P_FIFO_SIZES5_ADDR A:0x71c820
y.create.l HWIO_CRYPTO0_CRYPTO_BAM_P_FIFO_SIZES6_ADDR A:0x71d820
y.create.l HWIO_CRYPTO0_CRYPTO_BAM_P_FIFO_SIZES7_ADDR A:0x71e820
y.create.l HWIO_CRYPTO0_CRYPTO_BAM_P_DATA_FIFO_ADDR0_ADDR A:0x717824
y.create.l HWIO_CRYPTO0_CRYPTO_BAM_P_DATA_FIFO_ADDR1_ADDR A:0x718824
y.create.l HWIO_CRYPTO0_CRYPTO_BAM_P_DATA_FIFO_ADDR2_ADDR A:0x719824
y.create.l HWIO_CRYPTO0_CRYPTO_BAM_P_DATA_FIFO_ADDR3_ADDR A:0x71a824
y.create.l HWIO_CRYPTO0_CRYPTO_BAM_P_DATA_FIFO_ADDR4_ADDR A:0x71b824
y.create.l HWIO_CRYPTO0_CRYPTO_BAM_P_DATA_FIFO_ADDR5_ADDR A:0x71c824
y.create.l HWIO_CRYPTO0_CRYPTO_BAM_P_DATA_FIFO_ADDR6_ADDR A:0x71d824
y.create.l HWIO_CRYPTO0_CRYPTO_BAM_P_DATA_FIFO_ADDR7_ADDR A:0x71e824
y.create.l HWIO_CRYPTO0_CRYPTO_BAM_P_EVNT_GEN_TRSHLD0_ADDR A:0x717828
y.create.l HWIO_CRYPTO0_CRYPTO_BAM_P_EVNT_GEN_TRSHLD1_ADDR A:0x718828
y.create.l HWIO_CRYPTO0_CRYPTO_BAM_P_EVNT_GEN_TRSHLD2_ADDR A:0x719828
y.create.l HWIO_CRYPTO0_CRYPTO_BAM_P_EVNT_GEN_TRSHLD3_ADDR A:0x71a828
y.create.l HWIO_CRYPTO0_CRYPTO_BAM_P_EVNT_GEN_TRSHLD4_ADDR A:0x71b828
y.create.l HWIO_CRYPTO0_CRYPTO_BAM_P_EVNT_GEN_TRSHLD5_ADDR A:0x71c828
y.create.l HWIO_CRYPTO0_CRYPTO_BAM_P_EVNT_GEN_TRSHLD6_ADDR A:0x71d828
y.create.l HWIO_CRYPTO0_CRYPTO_BAM_P_EVNT_GEN_TRSHLD7_ADDR A:0x71e828
y.create.l HWIO_CRYPTO0_CRYPTO_BAM_P_EVNT_DEST_ADDR0_ADDR A:0x71782c
y.create.l HWIO_CRYPTO0_CRYPTO_BAM_P_EVNT_DEST_ADDR1_ADDR A:0x71882c
y.create.l HWIO_CRYPTO0_CRYPTO_BAM_P_EVNT_DEST_ADDR2_ADDR A:0x71982c
y.create.l HWIO_CRYPTO0_CRYPTO_BAM_P_EVNT_DEST_ADDR3_ADDR A:0x71a82c
y.create.l HWIO_CRYPTO0_CRYPTO_BAM_P_EVNT_DEST_ADDR4_ADDR A:0x71b82c
y.create.l HWIO_CRYPTO0_CRYPTO_BAM_P_EVNT_DEST_ADDR5_ADDR A:0x71c82c
y.create.l HWIO_CRYPTO0_CRYPTO_BAM_P_EVNT_DEST_ADDR6_ADDR A:0x71d82c
y.create.l HWIO_CRYPTO0_CRYPTO_BAM_P_EVNT_DEST_ADDR7_ADDR A:0x71e82c
y.create.l HWIO_CRYPTO0_CRYPTO_BAM_P_DF_CNTXT_0_ADDR A:0x717830
y.create.l HWIO_CRYPTO0_CRYPTO_BAM_P_DF_CNTXT_1_ADDR A:0x718830
y.create.l HWIO_CRYPTO0_CRYPTO_BAM_P_DF_CNTXT_2_ADDR A:0x719830
y.create.l HWIO_CRYPTO0_CRYPTO_BAM_P_DF_CNTXT_3_ADDR A:0x71a830
y.create.l HWIO_CRYPTO0_CRYPTO_BAM_P_DF_CNTXT_4_ADDR A:0x71b830
y.create.l HWIO_CRYPTO0_CRYPTO_BAM_P_DF_CNTXT_5_ADDR A:0x71c830
y.create.l HWIO_CRYPTO0_CRYPTO_BAM_P_DF_CNTXT_6_ADDR A:0x71d830
y.create.l HWIO_CRYPTO0_CRYPTO_BAM_P_DF_CNTXT_7_ADDR A:0x71e830
y.create.l HWIO_CRYPTO0_CRYPTO_BAM_P_RETR_CNTXT_0_ADDR A:0x717834
y.create.l HWIO_CRYPTO0_CRYPTO_BAM_P_RETR_CNTXT_1_ADDR A:0x718834
y.create.l HWIO_CRYPTO0_CRYPTO_BAM_P_RETR_CNTXT_2_ADDR A:0x719834
y.create.l HWIO_CRYPTO0_CRYPTO_BAM_P_RETR_CNTXT_3_ADDR A:0x71a834
y.create.l HWIO_CRYPTO0_CRYPTO_BAM_P_RETR_CNTXT_4_ADDR A:0x71b834
y.create.l HWIO_CRYPTO0_CRYPTO_BAM_P_RETR_CNTXT_5_ADDR A:0x71c834
y.create.l HWIO_CRYPTO0_CRYPTO_BAM_P_RETR_CNTXT_6_ADDR A:0x71d834
y.create.l HWIO_CRYPTO0_CRYPTO_BAM_P_RETR_CNTXT_7_ADDR A:0x71e834
y.create.l HWIO_CRYPTO0_CRYPTO_BAM_P_SI_CNTXT_0_ADDR A:0x717838
y.create.l HWIO_CRYPTO0_CRYPTO_BAM_P_SI_CNTXT_1_ADDR A:0x718838
y.create.l HWIO_CRYPTO0_CRYPTO_BAM_P_SI_CNTXT_2_ADDR A:0x719838
y.create.l HWIO_CRYPTO0_CRYPTO_BAM_P_SI_CNTXT_3_ADDR A:0x71a838
y.create.l HWIO_CRYPTO0_CRYPTO_BAM_P_SI_CNTXT_4_ADDR A:0x71b838
y.create.l HWIO_CRYPTO0_CRYPTO_BAM_P_SI_CNTXT_5_ADDR A:0x71c838
y.create.l HWIO_CRYPTO0_CRYPTO_BAM_P_SI_CNTXT_6_ADDR A:0x71d838
y.create.l HWIO_CRYPTO0_CRYPTO_BAM_P_SI_CNTXT_7_ADDR A:0x71e838
y.create.l HWIO_CRYPTO0_CRYPTO_BAM_P_PSM_CNTXT_3_LSB0_ADDR A:0x717900
y.create.l HWIO_CRYPTO0_CRYPTO_BAM_P_PSM_CNTXT_3_LSB1_ADDR A:0x718900
y.create.l HWIO_CRYPTO0_CRYPTO_BAM_P_PSM_CNTXT_3_LSB2_ADDR A:0x719900
y.create.l HWIO_CRYPTO0_CRYPTO_BAM_P_PSM_CNTXT_3_LSB3_ADDR A:0x71a900
y.create.l HWIO_CRYPTO0_CRYPTO_BAM_P_PSM_CNTXT_3_LSB4_ADDR A:0x71b900
y.create.l HWIO_CRYPTO0_CRYPTO_BAM_P_PSM_CNTXT_3_LSB5_ADDR A:0x71c900
y.create.l HWIO_CRYPTO0_CRYPTO_BAM_P_PSM_CNTXT_3_LSB6_ADDR A:0x71d900
y.create.l HWIO_CRYPTO0_CRYPTO_BAM_P_PSM_CNTXT_3_LSB7_ADDR A:0x71e900
y.create.l HWIO_CRYPTO0_CRYPTO_BAM_P_PSM_CNTXT_3_MSB0_ADDR A:0x717904
y.create.l HWIO_CRYPTO0_CRYPTO_BAM_P_PSM_CNTXT_3_MSB1_ADDR A:0x718904
y.create.l HWIO_CRYPTO0_CRYPTO_BAM_P_PSM_CNTXT_3_MSB2_ADDR A:0x719904
y.create.l HWIO_CRYPTO0_CRYPTO_BAM_P_PSM_CNTXT_3_MSB3_ADDR A:0x71a904
y.create.l HWIO_CRYPTO0_CRYPTO_BAM_P_PSM_CNTXT_3_MSB4_ADDR A:0x71b904
y.create.l HWIO_CRYPTO0_CRYPTO_BAM_P_PSM_CNTXT_3_MSB5_ADDR A:0x71c904
y.create.l HWIO_CRYPTO0_CRYPTO_BAM_P_PSM_CNTXT_3_MSB6_ADDR A:0x71d904
y.create.l HWIO_CRYPTO0_CRYPTO_BAM_P_PSM_CNTXT_3_MSB7_ADDR A:0x71e904
y.create.l HWIO_CRYPTO0_CRYPTO_BAM_P_DESC_FIFO_ADDR_LSB0_ADDR A:0x717910
y.create.l HWIO_CRYPTO0_CRYPTO_BAM_P_DESC_FIFO_ADDR_LSB1_ADDR A:0x718910
y.create.l HWIO_CRYPTO0_CRYPTO_BAM_P_DESC_FIFO_ADDR_LSB2_ADDR A:0x719910
y.create.l HWIO_CRYPTO0_CRYPTO_BAM_P_DESC_FIFO_ADDR_LSB3_ADDR A:0x71a910
y.create.l HWIO_CRYPTO0_CRYPTO_BAM_P_DESC_FIFO_ADDR_LSB4_ADDR A:0x71b910
y.create.l HWIO_CRYPTO0_CRYPTO_BAM_P_DESC_FIFO_ADDR_LSB5_ADDR A:0x71c910
y.create.l HWIO_CRYPTO0_CRYPTO_BAM_P_DESC_FIFO_ADDR_LSB6_ADDR A:0x71d910
y.create.l HWIO_CRYPTO0_CRYPTO_BAM_P_DESC_FIFO_ADDR_LSB7_ADDR A:0x71e910
y.create.l HWIO_CRYPTO0_CRYPTO_BAM_P_DESC_FIFO_ADDR_MSB0_ADDR A:0x717914
y.create.l HWIO_CRYPTO0_CRYPTO_BAM_P_DESC_FIFO_ADDR_MSB1_ADDR A:0x718914
y.create.l HWIO_CRYPTO0_CRYPTO_BAM_P_DESC_FIFO_ADDR_MSB2_ADDR A:0x719914
y.create.l HWIO_CRYPTO0_CRYPTO_BAM_P_DESC_FIFO_ADDR_MSB3_ADDR A:0x71a914
y.create.l HWIO_CRYPTO0_CRYPTO_BAM_P_DESC_FIFO_ADDR_MSB4_ADDR A:0x71b914
y.create.l HWIO_CRYPTO0_CRYPTO_BAM_P_DESC_FIFO_ADDR_MSB5_ADDR A:0x71c914
y.create.l HWIO_CRYPTO0_CRYPTO_BAM_P_DESC_FIFO_ADDR_MSB6_ADDR A:0x71d914
y.create.l HWIO_CRYPTO0_CRYPTO_BAM_P_DESC_FIFO_ADDR_MSB7_ADDR A:0x71e914
y.create.l HWIO_CRYPTO0_CRYPTO_BAM_P_DATA_FIFO_ADDR_LSB0_ADDR A:0x717920
y.create.l HWIO_CRYPTO0_CRYPTO_BAM_P_DATA_FIFO_ADDR_LSB1_ADDR A:0x718920
y.create.l HWIO_CRYPTO0_CRYPTO_BAM_P_DATA_FIFO_ADDR_LSB2_ADDR A:0x719920
y.create.l HWIO_CRYPTO0_CRYPTO_BAM_P_DATA_FIFO_ADDR_LSB3_ADDR A:0x71a920
y.create.l HWIO_CRYPTO0_CRYPTO_BAM_P_DATA_FIFO_ADDR_LSB4_ADDR A:0x71b920
y.create.l HWIO_CRYPTO0_CRYPTO_BAM_P_DATA_FIFO_ADDR_LSB5_ADDR A:0x71c920
y.create.l HWIO_CRYPTO0_CRYPTO_BAM_P_DATA_FIFO_ADDR_LSB6_ADDR A:0x71d920
y.create.l HWIO_CRYPTO0_CRYPTO_BAM_P_DATA_FIFO_ADDR_LSB7_ADDR A:0x71e920
y.create.l HWIO_CRYPTO0_CRYPTO_BAM_P_DATA_FIFO_ADDR_MSB0_ADDR A:0x717924
y.create.l HWIO_CRYPTO0_CRYPTO_BAM_P_DATA_FIFO_ADDR_MSB1_ADDR A:0x718924
y.create.l HWIO_CRYPTO0_CRYPTO_BAM_P_DATA_FIFO_ADDR_MSB2_ADDR A:0x719924
y.create.l HWIO_CRYPTO0_CRYPTO_BAM_P_DATA_FIFO_ADDR_MSB3_ADDR A:0x71a924
y.create.l HWIO_CRYPTO0_CRYPTO_BAM_P_DATA_FIFO_ADDR_MSB4_ADDR A:0x71b924
y.create.l HWIO_CRYPTO0_CRYPTO_BAM_P_DATA_FIFO_ADDR_MSB5_ADDR A:0x71c924
y.create.l HWIO_CRYPTO0_CRYPTO_BAM_P_DATA_FIFO_ADDR_MSB6_ADDR A:0x71d924
y.create.l HWIO_CRYPTO0_CRYPTO_BAM_P_DATA_FIFO_ADDR_MSB7_ADDR A:0x71e924
y.create.l HWIO_CRYPTO0_CRYPTO_BAM_P_EVNT_DEST_ADDR_LSB0_ADDR A:0x717930
y.create.l HWIO_CRYPTO0_CRYPTO_BAM_P_EVNT_DEST_ADDR_LSB1_ADDR A:0x718930
y.create.l HWIO_CRYPTO0_CRYPTO_BAM_P_EVNT_DEST_ADDR_LSB2_ADDR A:0x719930
y.create.l HWIO_CRYPTO0_CRYPTO_BAM_P_EVNT_DEST_ADDR_LSB3_ADDR A:0x71a930
y.create.l HWIO_CRYPTO0_CRYPTO_BAM_P_EVNT_DEST_ADDR_LSB4_ADDR A:0x71b930
y.create.l HWIO_CRYPTO0_CRYPTO_BAM_P_EVNT_DEST_ADDR_LSB5_ADDR A:0x71c930
y.create.l HWIO_CRYPTO0_CRYPTO_BAM_P_EVNT_DEST_ADDR_LSB6_ADDR A:0x71d930
y.create.l HWIO_CRYPTO0_CRYPTO_BAM_P_EVNT_DEST_ADDR_LSB7_ADDR A:0x71e930
y.create.l HWIO_CRYPTO0_CRYPTO_BAM_P_EVNT_DEST_ADDR_MSB0_ADDR A:0x717934
y.create.l HWIO_CRYPTO0_CRYPTO_BAM_P_EVNT_DEST_ADDR_MSB1_ADDR A:0x718934
y.create.l HWIO_CRYPTO0_CRYPTO_BAM_P_EVNT_DEST_ADDR_MSB2_ADDR A:0x719934
y.create.l HWIO_CRYPTO0_CRYPTO_BAM_P_EVNT_DEST_ADDR_MSB3_ADDR A:0x71a934
y.create.l HWIO_CRYPTO0_CRYPTO_BAM_P_EVNT_DEST_ADDR_MSB4_ADDR A:0x71b934
y.create.l HWIO_CRYPTO0_CRYPTO_BAM_P_EVNT_DEST_ADDR_MSB5_ADDR A:0x71c934
y.create.l HWIO_CRYPTO0_CRYPTO_BAM_P_EVNT_DEST_ADDR_MSB6_ADDR A:0x71d934
y.create.l HWIO_CRYPTO0_CRYPTO_BAM_P_EVNT_DEST_ADDR_MSB7_ADDR A:0x71e934
y.create.l HWIO_CRYPTO0_CRYPTO_BAM_XPU_SCR_ADDR A:0x702000
y.create.l HWIO_CRYPTO0_CRYPTO_BAM_XPU_SWDR_ADDR A:0x702004
y.create.l HWIO_CRYPTO0_CRYPTO_BAM_XPU_SEAR0_ADDR A:0x702040
y.create.l HWIO_CRYPTO0_CRYPTO_BAM_XPU_SESR_ADDR A:0x702048
y.create.l HWIO_CRYPTO0_CRYPTO_BAM_XPU_SESRRESTORE_ADDR A:0x70204c
y.create.l HWIO_CRYPTO0_CRYPTO_BAM_XPU_SESYNR0_ADDR A:0x702050
y.create.l HWIO_CRYPTO0_CRYPTO_BAM_XPU_SESYNR1_ADDR A:0x702054
y.create.l HWIO_CRYPTO0_CRYPTO_BAM_XPU_SESYNR2_ADDR A:0x702058
y.create.l HWIO_CRYPTO0_CRYPTO_BAM_XPU_MCR_ADDR A:0x702100
y.create.l HWIO_CRYPTO0_CRYPTO_BAM_XPU_MEAR0_ADDR A:0x702140
y.create.l HWIO_CRYPTO0_CRYPTO_BAM_XPU_MESR_ADDR A:0x702148
y.create.l HWIO_CRYPTO0_CRYPTO_BAM_XPU_MESRRESTORE_ADDR A:0x70214c
y.create.l HWIO_CRYPTO0_CRYPTO_BAM_XPU_MESYNR0_ADDR A:0x702150
y.create.l HWIO_CRYPTO0_CRYPTO_BAM_XPU_MESYNR1_ADDR A:0x702154
y.create.l HWIO_CRYPTO0_CRYPTO_BAM_XPU_MESYNR2_ADDR A:0x702158
y.create.l HWIO_CRYPTO0_CRYPTO_BAM_XPU_CR_ADDR A:0x702080
y.create.l HWIO_CRYPTO0_CRYPTO_BAM_XPU_RPU_ACR0_ADDR A:0x7020a0
y.create.l HWIO_CRYPTO0_CRYPTO_BAM_XPU_EAR0_ADDR A:0x7020c0
y.create.l HWIO_CRYPTO0_CRYPTO_BAM_XPU_ESR_ADDR A:0x7020c8
y.create.l HWIO_CRYPTO0_CRYPTO_BAM_XPU_ESRRESTORE_ADDR A:0x7020cc
y.create.l HWIO_CRYPTO0_CRYPTO_BAM_XPU_ESYNR0_ADDR A:0x7020d0
y.create.l HWIO_CRYPTO0_CRYPTO_BAM_XPU_ESYNR1_ADDR A:0x7020d4
y.create.l HWIO_CRYPTO0_CRYPTO_BAM_XPU_ESYNR2_ADDR A:0x7020d8
y.create.l HWIO_CRYPTO0_CRYPTO_BAM_XPU_IDR0_ADDR A:0x702074
y.create.l HWIO_CRYPTO0_CRYPTO_BAM_XPU_IDR1_ADDR A:0x702078
y.create.l HWIO_CRYPTO0_CRYPTO_BAM_XPU_REV_ADDR A:0x70207c
y.create.l HWIO_CRYPTO0_CRYPTO_BAM_XPU_RG0_RACR0_ADDR A:0x702200
y.create.l HWIO_CRYPTO0_CRYPTO_BAM_XPU_RG1_RACR0_ADDR A:0x702280
y.create.l HWIO_CRYPTO0_CRYPTO_BAM_XPU_RG2_RACR0_ADDR A:0x702300
y.create.l HWIO_CRYPTO0_CRYPTO_BAM_XPU_RG3_RACR0_ADDR A:0x702380
y.create.l HWIO_CRYPTO0_CRYPTO_BAM_XPU_RG4_RACR0_ADDR A:0x702400
y.create.l HWIO_CRYPTO0_CRYPTO_BAM_XPU_RG5_RACR0_ADDR A:0x702480
y.create.l HWIO_CRYPTO0_CRYPTO_BAM_XPU_RG6_RACR0_ADDR A:0x702500
y.create.l HWIO_CRYPTO0_CRYPTO_BAM_XPU_RG7_RACR0_ADDR A:0x702580
y.create.l HWIO_CRYPTO0_CRYPTO_BAM_XPU_RG8_RACR0_ADDR A:0x702600
y.create.l HWIO_CRYPTO0_CRYPTO_BAM_XPU_RG9_RACR0_ADDR A:0x702680
y.create.l HWIO_CRYPTO0_CRYPTO_BAM_XPU_RG0_SCR_ADDR A:0x702250
y.create.l HWIO_CRYPTO0_CRYPTO_BAM_XPU_RG1_SCR_ADDR A:0x7022d0
y.create.l HWIO_CRYPTO0_CRYPTO_BAM_XPU_RG2_SCR_ADDR A:0x702350
y.create.l HWIO_CRYPTO0_CRYPTO_BAM_XPU_RG3_SCR_ADDR A:0x7023d0
y.create.l HWIO_CRYPTO0_CRYPTO_BAM_XPU_RG4_SCR_ADDR A:0x702450
y.create.l HWIO_CRYPTO0_CRYPTO_BAM_XPU_RG5_SCR_ADDR A:0x7024d0
y.create.l HWIO_CRYPTO0_CRYPTO_BAM_XPU_RG6_SCR_ADDR A:0x702550
y.create.l HWIO_CRYPTO0_CRYPTO_BAM_XPU_RG7_SCR_ADDR A:0x7025d0
y.create.l HWIO_CRYPTO0_CRYPTO_BAM_XPU_RG8_SCR_ADDR A:0x702650
y.create.l HWIO_CRYPTO0_CRYPTO_BAM_XPU_RG9_SCR_ADDR A:0x7026d0
y.create.l HWIO_CRYPTO0_CRYPTO_BAM_XPU_RG0_MCR_ADDR A:0x702254
y.create.l HWIO_CRYPTO0_CRYPTO_BAM_XPU_RG1_MCR_ADDR A:0x7022d4
y.create.l HWIO_CRYPTO0_CRYPTO_BAM_XPU_RG2_MCR_ADDR A:0x702354
y.create.l HWIO_CRYPTO0_CRYPTO_BAM_XPU_RG3_MCR_ADDR A:0x7023d4
y.create.l HWIO_CRYPTO0_CRYPTO_BAM_XPU_RG4_MCR_ADDR A:0x702454
y.create.l HWIO_CRYPTO0_CRYPTO_BAM_XPU_RG5_MCR_ADDR A:0x7024d4
y.create.l HWIO_CRYPTO0_CRYPTO_BAM_XPU_RG6_MCR_ADDR A:0x702554
y.create.l HWIO_CRYPTO0_CRYPTO_BAM_XPU_RG7_MCR_ADDR A:0x7025d4
y.create.l HWIO_CRYPTO0_CRYPTO_BAM_XPU_RG8_MCR_ADDR A:0x702654
y.create.l HWIO_CRYPTO0_CRYPTO_BAM_XPU_RG9_MCR_ADDR A:0x7026d4
y.create.l HWIO_CRYPTO0_CRYPTO_BAM_VMIDMT_SCR0_ADDR A:0x700000
y.create.l HWIO_CRYPTO0_CRYPTO_BAM_VMIDMT_SCR1_ADDR A:0x700004
y.create.l HWIO_CRYPTO0_CRYPTO_BAM_VMIDMT_SCR2_ADDR A:0x700008
y.create.l HWIO_CRYPTO0_CRYPTO_BAM_VMIDMT_SACR_ADDR A:0x700010
y.create.l HWIO_CRYPTO0_CRYPTO_BAM_VMIDMT_SIDR0_ADDR A:0x700020
y.create.l HWIO_CRYPTO0_CRYPTO_BAM_VMIDMT_SIDR1_ADDR A:0x700024
y.create.l HWIO_CRYPTO0_CRYPTO_BAM_VMIDMT_SIDR2_ADDR A:0x700028
y.create.l HWIO_CRYPTO0_CRYPTO_BAM_VMIDMT_SIDR4_ADDR A:0x700030
y.create.l HWIO_CRYPTO0_CRYPTO_BAM_VMIDMT_SIDR5_ADDR A:0x700034
y.create.l HWIO_CRYPTO0_CRYPTO_BAM_VMIDMT_SIDR7_ADDR A:0x70003c
y.create.l HWIO_CRYPTO0_CRYPTO_BAM_VMIDMT_SGFAR0_ADDR A:0x700040
y.create.l HWIO_CRYPTO0_CRYPTO_BAM_VMIDMT_SGFSR_ADDR A:0x700048
y.create.l HWIO_CRYPTO0_CRYPTO_BAM_VMIDMT_SGFSRRESTORE_ADDR A:0x70004c
y.create.l HWIO_CRYPTO0_CRYPTO_BAM_VMIDMT_SGFSYNDR0_ADDR A:0x700050
y.create.l HWIO_CRYPTO0_CRYPTO_BAM_VMIDMT_SGFSYNDR1_ADDR A:0x700054
y.create.l HWIO_CRYPTO0_CRYPTO_BAM_VMIDMT_SGFSYNDR2_ADDR A:0x700058
y.create.l HWIO_CRYPTO0_CRYPTO_BAM_VMIDMT_VMIDMTSCR0_ADDR A:0x700090
y.create.l HWIO_CRYPTO0_CRYPTO_BAM_VMIDMT_CR0_ADDR A:0x700000
y.create.l HWIO_CRYPTO0_CRYPTO_BAM_VMIDMT_CR2_ADDR A:0x700008
y.create.l HWIO_CRYPTO0_CRYPTO_BAM_VMIDMT_ACR_ADDR A:0x700010
y.create.l HWIO_CRYPTO0_CRYPTO_BAM_VMIDMT_IDR0_ADDR A:0x700020
y.create.l HWIO_CRYPTO0_CRYPTO_BAM_VMIDMT_IDR1_ADDR A:0x700024
y.create.l HWIO_CRYPTO0_CRYPTO_BAM_VMIDMT_IDR2_ADDR A:0x700028
y.create.l HWIO_CRYPTO0_CRYPTO_BAM_VMIDMT_IDR4_ADDR A:0x700030
y.create.l HWIO_CRYPTO0_CRYPTO_BAM_VMIDMT_IDR5_ADDR A:0x700034
y.create.l HWIO_CRYPTO0_CRYPTO_BAM_VMIDMT_IDR7_ADDR A:0x70003c
y.create.l HWIO_CRYPTO0_CRYPTO_BAM_VMIDMT_GFAR0_ADDR A:0x700040
y.create.l HWIO_CRYPTO0_CRYPTO_BAM_VMIDMT_GFSR_ADDR A:0x700048
y.create.l HWIO_CRYPTO0_CRYPTO_BAM_VMIDMT_GFSRRESTORE_ADDR A:0x70004c
y.create.l HWIO_CRYPTO0_CRYPTO_BAM_VMIDMT_GFSYNDR0_ADDR A:0x700050
y.create.l HWIO_CRYPTO0_CRYPTO_BAM_VMIDMT_GFSYNDR1_ADDR A:0x700054
y.create.l HWIO_CRYPTO0_CRYPTO_BAM_VMIDMT_GFSYNDR2_ADDR A:0x700058
y.create.l HWIO_CRYPTO0_CRYPTO_BAM_VMIDMT_VMIDMTCR0_ADDR A:0x700090
y.create.l HWIO_CRYPTO0_CRYPTO_BAM_VMIDMT_VMIDMTACR_ADDR A:0x70009c
y.create.l HWIO_CRYPTO0_CRYPTO_BAM_VMIDMT_NSCR0_ADDR A:0x700400
y.create.l HWIO_CRYPTO0_CRYPTO_BAM_VMIDMT_NSCR2_ADDR A:0x700408
y.create.l HWIO_CRYPTO0_CRYPTO_BAM_VMIDMT_NSACR_ADDR A:0x700410
y.create.l HWIO_CRYPTO0_CRYPTO_BAM_VMIDMT_NSGFAR0_ADDR A:0x700440
y.create.l HWIO_CRYPTO0_CRYPTO_BAM_VMIDMT_NSGFSR_ADDR A:0x700448
y.create.l HWIO_CRYPTO0_CRYPTO_BAM_VMIDMT_NSGFSRRESTORE_ADDR A:0x70044c
y.create.l HWIO_CRYPTO0_CRYPTO_BAM_VMIDMT_NSGFSYNDR0_ADDR A:0x700450
y.create.l HWIO_CRYPTO0_CRYPTO_BAM_VMIDMT_NSGFSYNDR1_ADDR A:0x700454
y.create.l HWIO_CRYPTO0_CRYPTO_BAM_VMIDMT_NSGFSYNDR2_ADDR A:0x700458
y.create.l HWIO_CRYPTO0_CRYPTO_BAM_VMIDMT_NSVMIDMTCR0_ADDR A:0x700490
y.create.l HWIO_CRYPTO0_CRYPTO_BAM_VMIDMT_SSDR0_ADDR A:0x700080
y.create.l HWIO_CRYPTO0_CRYPTO_BAM_VMIDMT_MSDR0_ADDR A:0x700480
y.create.l HWIO_CRYPTO0_CRYPTO_BAM_VMIDMT_MCR_ADDR A:0x700494
y.create.l HWIO_CRYPTO0_CRYPTO_BAM_VMIDMT_S2VR0_ADDR A:0x700c00
y.create.l HWIO_CRYPTO0_CRYPTO_BAM_VMIDMT_S2VR1_ADDR A:0x700c04
y.create.l HWIO_CRYPTO0_CRYPTO_BAM_VMIDMT_S2VR2_ADDR A:0x700c08
y.create.l HWIO_CRYPTO0_CRYPTO_BAM_VMIDMT_S2VR3_ADDR A:0x700c0c
y.create.l HWIO_CRYPTO0_CRYPTO_BAM_VMIDMT_S2VR4_ADDR A:0x700c10
y.create.l HWIO_CRYPTO0_CRYPTO_BAM_VMIDMT_S2VR5_ADDR A:0x700c14
y.create.l HWIO_CRYPTO0_CRYPTO_BAM_VMIDMT_S2VR6_ADDR A:0x700c18
y.create.l HWIO_CRYPTO0_CRYPTO_BAM_VMIDMT_S2VR7_ADDR A:0x700c1c
y.create.l HWIO_CRYPTO0_CRYPTO_BAM_VMIDMT_S2VR8_ADDR A:0x700c20
y.create.l HWIO_CRYPTO0_CRYPTO_BAM_VMIDMT_AS2VR0_ADDR A:0x700e00
y.create.l HWIO_CRYPTO0_CRYPTO_BAM_VMIDMT_AS2VR1_ADDR A:0x700e04
y.create.l HWIO_CRYPTO0_CRYPTO_BAM_VMIDMT_AS2VR2_ADDR A:0x700e08
y.create.l HWIO_CRYPTO0_CRYPTO_BAM_VMIDMT_AS2VR3_ADDR A:0x700e0c
y.create.l HWIO_CRYPTO0_CRYPTO_BAM_VMIDMT_AS2VR4_ADDR A:0x700e10
y.create.l HWIO_CRYPTO0_CRYPTO_BAM_VMIDMT_AS2VR5_ADDR A:0x700e14
y.create.l HWIO_CRYPTO0_CRYPTO_BAM_VMIDMT_AS2VR6_ADDR A:0x700e18
y.create.l HWIO_CRYPTO0_CRYPTO_BAM_VMIDMT_AS2VR7_ADDR A:0x700e1c
y.create.l HWIO_CRYPTO0_CRYPTO_BAM_VMIDMT_AS2VR8_ADDR A:0x700e20
y.create.l HWIO_CRYPTO0_CRYPTO_BAM_VMIDMT_SMR0_ADDR A:0x700800
y.create.l HWIO_CRYPTO0_CRYPTO_BAM_VMIDMT_SMR1_ADDR A:0x700804
y.create.l HWIO_CRYPTO0_CRYPTO_BAM_VMIDMT_SMR2_ADDR A:0x700808
y.create.l HWIO_CRYPTO0_CRYPTO_BAM_VMIDMT_SMR3_ADDR A:0x70080c
y.create.l HWIO_CRYPTO0_CRYPTO_BAM_VMIDMT_SMR4_ADDR A:0x700810
y.create.l HWIO_CRYPTO0_CRYPTO_BAM_VMIDMT_SMR5_ADDR A:0x700814
y.create.l HWIO_CRYPTO0_CRYPTO_BAM_VMIDMT_SMR6_ADDR A:0x700818
y.create.l HWIO_CRYPTO0_CRYPTO_BAM_VMIDMT_SMR7_ADDR A:0x70081c
y.create.l HWIO_CRYPTO0_CRYPTO_BAM_VMIDMT_SMR8_ADDR A:0x700820
y.create.l HWIO_DEHR_BIMC_DEHR_HW_VERSION_ADDR A:0x4b2000
y.create.l HWIO_DEHR_BIMC_DEHR_HW_INFO_ADDR A:0x4b2004
y.create.l HWIO_DEHR_BIMC_DEHR_CGC_CFG_ADDR A:0x4b2010
y.create.l HWIO_DEHR_BIMC_DEHR_MSA_CFG_ADDR A:0x4b2104
y.create.l HWIO_DEHR_BIMC_DEHR_RAM_CFG_ADDR A:0x4b2140
y.create.l HWIO_DEHR_BIMC_DEHR_DMA_STATUS_ADDR A:0x4b2200
y.create.l HWIO_DEHR_BIMC_DEHR_DBG_CFG_ADDR A:0x4b2400
y.create.l HWIO_DEHR_BIMC_DEHR_SW_DMA_CFG_ADDR A:0x4b2404
y.create.l HWIO_DEHR_BIMC_DEHR_DBG_ADDR_ADDR A:0x4b2408
y.create.l HWIO_DEHR_BIMC_DEHR_SEC_CFG_ADDR A:0x4b3000
y.create.l HWIO_DEHR_XPU_SCR_ADDR A:0x4b0000
y.create.l HWIO_DEHR_XPU_SWDR_ADDR A:0x4b0004
y.create.l HWIO_DEHR_XPU_SEAR0_ADDR A:0x4b0040
y.create.l HWIO_DEHR_XPU_SESR_ADDR A:0x4b0048
y.create.l HWIO_DEHR_XPU_SESRRESTORE_ADDR A:0x4b004c
y.create.l HWIO_DEHR_XPU_SESYNR0_ADDR A:0x4b0050
y.create.l HWIO_DEHR_XPU_SESYNR1_ADDR A:0x4b0054
y.create.l HWIO_DEHR_XPU_SESYNR2_ADDR A:0x4b0058
y.create.l HWIO_DEHR_XPU_MCR_ADDR A:0x4b0100
y.create.l HWIO_DEHR_XPU_MEAR0_ADDR A:0x4b0140
y.create.l HWIO_DEHR_XPU_MESR_ADDR A:0x4b0148
y.create.l HWIO_DEHR_XPU_MESRRESTORE_ADDR A:0x4b014c
y.create.l HWIO_DEHR_XPU_MESYNR0_ADDR A:0x4b0150
y.create.l HWIO_DEHR_XPU_MESYNR1_ADDR A:0x4b0154
y.create.l HWIO_DEHR_XPU_MESYNR2_ADDR A:0x4b0158
y.create.l HWIO_DEHR_XPU_CR_ADDR A:0x4b0080
y.create.l HWIO_DEHR_XPU_RPU_ACR0_ADDR A:0x4b00a0
y.create.l HWIO_DEHR_XPU_EAR0_ADDR A:0x4b00c0
y.create.l HWIO_DEHR_XPU_ESR_ADDR A:0x4b00c8
y.create.l HWIO_DEHR_XPU_ESRRESTORE_ADDR A:0x4b00cc
y.create.l HWIO_DEHR_XPU_ESYNR0_ADDR A:0x4b00d0
y.create.l HWIO_DEHR_XPU_ESYNR1_ADDR A:0x4b00d4
y.create.l HWIO_DEHR_XPU_ESYNR2_ADDR A:0x4b00d8
y.create.l HWIO_DEHR_XPU_IDR0_ADDR A:0x4b0074
y.create.l HWIO_DEHR_XPU_IDR1_ADDR A:0x4b0078
y.create.l HWIO_DEHR_XPU_REV_ADDR A:0x4b007c
y.create.l HWIO_DEHR_XPU_RG0_RACR0_ADDR A:0x4b0200
y.create.l HWIO_DEHR_XPU_RG1_RACR0_ADDR A:0x4b0280
y.create.l HWIO_DEHR_XPU_RG0_SCR_ADDR A:0x4b0250
y.create.l HWIO_DEHR_XPU_RG1_SCR_ADDR A:0x4b02d0
y.create.l HWIO_DEHR_XPU_RG0_MCR_ADDR A:0x4b0254
y.create.l HWIO_DEHR_XPU_RG1_MCR_ADDR A:0x4b02d4
y.create.l HWIO_DEHR_VMIDMT_SCR0_ADDR A:0x4b1000
y.create.l HWIO_DEHR_VMIDMT_SCR1_ADDR A:0x4b1004
y.create.l HWIO_DEHR_VMIDMT_SCR2_ADDR A:0x4b1008
y.create.l HWIO_DEHR_VMIDMT_SACR_ADDR A:0x4b1010
y.create.l HWIO_DEHR_VMIDMT_SIDR0_ADDR A:0x4b1020
y.create.l HWIO_DEHR_VMIDMT_SIDR1_ADDR A:0x4b1024
y.create.l HWIO_DEHR_VMIDMT_SIDR2_ADDR A:0x4b1028
y.create.l HWIO_DEHR_VMIDMT_SIDR4_ADDR A:0x4b1030
y.create.l HWIO_DEHR_VMIDMT_SIDR5_ADDR A:0x4b1034
y.create.l HWIO_DEHR_VMIDMT_SIDR7_ADDR A:0x4b103c
y.create.l HWIO_DEHR_VMIDMT_SGFAR0_ADDR A:0x4b1040
y.create.l HWIO_DEHR_VMIDMT_SGFSR_ADDR A:0x4b1048
y.create.l HWIO_DEHR_VMIDMT_SGFSRRESTORE_ADDR A:0x4b104c
y.create.l HWIO_DEHR_VMIDMT_SGFSYNDR0_ADDR A:0x4b1050
y.create.l HWIO_DEHR_VMIDMT_SGFSYNDR1_ADDR A:0x4b1054
y.create.l HWIO_DEHR_VMIDMT_SGFSYNDR2_ADDR A:0x4b1058
y.create.l HWIO_DEHR_VMIDMT_VMIDMTSCR0_ADDR A:0x4b1090
y.create.l HWIO_DEHR_VMIDMT_CR0_ADDR A:0x4b1000
y.create.l HWIO_DEHR_VMIDMT_CR2_ADDR A:0x4b1008
y.create.l HWIO_DEHR_VMIDMT_ACR_ADDR A:0x4b1010
y.create.l HWIO_DEHR_VMIDMT_IDR0_ADDR A:0x4b1020
y.create.l HWIO_DEHR_VMIDMT_IDR1_ADDR A:0x4b1024
y.create.l HWIO_DEHR_VMIDMT_IDR2_ADDR A:0x4b1028
y.create.l HWIO_DEHR_VMIDMT_IDR4_ADDR A:0x4b1030
y.create.l HWIO_DEHR_VMIDMT_IDR5_ADDR A:0x4b1034
y.create.l HWIO_DEHR_VMIDMT_IDR7_ADDR A:0x4b103c
y.create.l HWIO_DEHR_VMIDMT_GFAR0_ADDR A:0x4b1040
y.create.l HWIO_DEHR_VMIDMT_GFSR_ADDR A:0x4b1048
y.create.l HWIO_DEHR_VMIDMT_GFSRRESTORE_ADDR A:0x4b104c
y.create.l HWIO_DEHR_VMIDMT_GFSYNDR0_ADDR A:0x4b1050
y.create.l HWIO_DEHR_VMIDMT_GFSYNDR1_ADDR A:0x4b1054
y.create.l HWIO_DEHR_VMIDMT_GFSYNDR2_ADDR A:0x4b1058
y.create.l HWIO_DEHR_VMIDMT_VMIDMTCR0_ADDR A:0x4b1090
y.create.l HWIO_DEHR_VMIDMT_VMIDMTACR_ADDR A:0x4b109c
y.create.l HWIO_DEHR_VMIDMT_NSCR0_ADDR A:0x4b1400
y.create.l HWIO_DEHR_VMIDMT_NSCR2_ADDR A:0x4b1408
y.create.l HWIO_DEHR_VMIDMT_NSACR_ADDR A:0x4b1410
y.create.l HWIO_DEHR_VMIDMT_NSGFAR0_ADDR A:0x4b1440
y.create.l HWIO_DEHR_VMIDMT_NSGFSR_ADDR A:0x4b1448
y.create.l HWIO_DEHR_VMIDMT_NSGFSRRESTORE_ADDR A:0x4b144c
y.create.l HWIO_DEHR_VMIDMT_NSGFSYNDR0_ADDR A:0x4b1450
y.create.l HWIO_DEHR_VMIDMT_NSGFSYNDR1_ADDR A:0x4b1454
y.create.l HWIO_DEHR_VMIDMT_NSGFSYNDR2_ADDR A:0x4b1458
y.create.l HWIO_DEHR_VMIDMT_NSVMIDMTCR0_ADDR A:0x4b1490
y.create.l HWIO_DEHR_VMIDMT_SSDR0_ADDR A:0x4b1080
y.create.l HWIO_DEHR_VMIDMT_MSDR0_ADDR A:0x4b1480
y.create.l HWIO_DEHR_VMIDMT_MCR_ADDR A:0x4b1494
y.create.l HWIO_DEHR_VMIDMT_S2VR0_ADDR A:0x4b1c00
y.create.l HWIO_DEHR_VMIDMT_AS2VR0_ADDR A:0x4b1e00
y.create.l HWIO_DIM_C00_DIM_CA_TOP_CFG_ADDR A:0x480000
y.create.l HWIO_DIM_C00_DIM_CA_HW_INFO_ADDR A:0x480004
y.create.l HWIO_DIM_C00_DIM_CA_HW_VERSION_ADDR A:0x480008
y.create.l HWIO_DIM_C00_DIM_CA_PAD_CFG0_ADDR A:0x480010
y.create.l HWIO_DIM_C00_DIM_CA_PAD_CFG1_ADDR A:0x480014
y.create.l HWIO_DIM_C00_DIM_CA_PAD_CFG2_ADDR A:0x480018
y.create.l HWIO_DIM_C00_DIM_CA_PAD_CFG3_ADDR A:0x48001c
y.create.l HWIO_DIM_C00_DIM_CA_PAD_CFG4_ADDR A:0x480020
y.create.l HWIO_DIM_C00_DDRPHY_CA_MISR_CFG_ADDR A:0x480024
y.create.l HWIO_DIM_C00_DDRPHY_CA_MISR_EVEN_STATUS_ADDR A:0x480028
y.create.l HWIO_DIM_C00_DDRPHY_CA_MISR_ODD_STATUS_ADDR A:0x48002c
y.create.l HWIO_DIM_C00_DIM_CA_CDC_CTLR_CFG0_ADDR A:0x480030
y.create.l HWIO_DIM_C00_DIM_CA_CDC_CTLR_CFG1_ADDR A:0x480034
y.create.l HWIO_DIM_C00_DIM_CA_CDC_CAL_TIMER_CFG0_ADDR A:0x480038
y.create.l HWIO_DIM_C00_DIM_CA_CDC_CAL_TIMER_CFG1_ADDR A:0x48003c
y.create.l HWIO_DIM_C00_DIM_CA_CDC_REFCOUNT_CFG_ADDR A:0x480040
y.create.l HWIO_DIM_C00_DIM_CA_CDC_COARSE_CAL_CFG_ADDR A:0x480044
y.create.l HWIO_DIM_C00_DIM_CA_CDC_RSVD_CFG_ADDR A:0x480048
y.create.l HWIO_DIM_C00_DIM_CA_CDC_OFFSET_CFG_ADDR A:0x48004c
y.create.l HWIO_DIM_C00_DIM_CA_CDC_DELAY_CFG_ADDR A:0x480050
y.create.l HWIO_DIM_C00_DIM_CA_CDC_SW_MODE_CFG_ADDR A:0x480054
y.create.l HWIO_DIM_C00_DIM_CA_CDC_TEST_CFG_ADDR A:0x480058
y.create.l HWIO_DIM_C00_DIM_CA_CDC_SW_OVRD_CFG_ADDR A:0x48005c
y.create.l HWIO_DIM_C00_DIM_CA_CDC_STATUS0_ADDR A:0x480070
y.create.l HWIO_DIM_C00_DIM_CA_CDC_STATUS1_ADDR A:0x480074
y.create.l HWIO_DIM_C00_DIM_CA_CDC_STATUS2_ADDR A:0x480078
y.create.l HWIO_DIM_C00_DIM_CA_CDC_STATUS3_ADDR A:0x48007c
y.create.l HWIO_DIM_C00_DIM_CA_IOC_CTLR_CFG_ADDR A:0x4800e0
y.create.l HWIO_DIM_C00_DIM_CA_IOC_CTLR_PNCNT_CFG_ADDR A:0x4800e4
y.create.l HWIO_DIM_C00_DIM_CA_IOC_CTLR_TIMER_CFG_ADDR A:0x4800e8
y.create.l HWIO_DIM_C00_DIM_CA_IOC_CTLR_TIMER_STATUS_ADDR A:0x4800ec
y.create.l HWIO_DIM_C00_DIM_CA_IOC_CTLR_CHAR_CFG_ADDR A:0x4800f0
y.create.l HWIO_DIM_C00_DIM_CA_IOC_CTLR_STATUS_ADDR A:0x4800f4
y.create.l HWIO_DIM_C00_DIM_CA_CA_IOC_SLV_CFG_ADDR A:0x480100
y.create.l HWIO_DIM_C00_DIM_CA_CA_IOC_SLV_STATUS_ADDR A:0x480104
y.create.l HWIO_DIM_C00_DIM_CA_CK_IOC_SLV_CFG_ADDR A:0x480110
y.create.l HWIO_DIM_C00_DIM_CA_CK_IOC_SLV_STATUS_ADDR A:0x480114
y.create.l HWIO_DIM_D00_DIM_DQ_TOP_CFG_ADDR A:0x480800
y.create.l HWIO_DIM_D00_DIM_DQ_HW_INFO_ADDR A:0x480804
y.create.l HWIO_DIM_D00_DIM_DQ_HW_VERSION_ADDR A:0x480808
y.create.l HWIO_DIM_D00_DIM_DQ_PAD_CFG0_ADDR A:0x480810
y.create.l HWIO_DIM_D00_DIM_DQ_PAD_CFG1_ADDR A:0x480814
y.create.l HWIO_DIM_D00_DIM_DQ_PAD_CFG2_ADDR A:0x480818
y.create.l HWIO_DIM_D00_DIM_DQ_DQ_SMT_STATUS_ADDR A:0x48081c
y.create.l HWIO_DIM_D00_DIM_DQ_PAD_CFG3_ADDR A:0x480820
y.create.l HWIO_DIM_D00_DDRPHY_DQ_MISR_CFG_ADDR A:0x48080c
y.create.l HWIO_DIM_D00_DDRPHY_DQ_MISR_EVEN_STATUS_ADDR A:0x480828
y.create.l HWIO_DIM_D00_DDRPHY_DQ_MISR_ODD_STATUS_ADDR A:0x48082c
y.create.l HWIO_DIM_D00_DIM_DQ_CDC_CTLR_CFG0_ADDR A:0x480830
y.create.l HWIO_DIM_D00_DIM_DQ_CDC_CTLR_CFG1_ADDR A:0x480834
y.create.l HWIO_DIM_D00_DIM_DQ_CDC_CAL_TIMER_CFG0_ADDR A:0x480838
y.create.l HWIO_DIM_D00_DIM_DQ_CDC_CAL_TIMER_CFG1_ADDR A:0x48083c
y.create.l HWIO_DIM_D00_DIM_DQ_CDC_REFCOUNT_CFG_ADDR A:0x480840
y.create.l HWIO_DIM_D00_DIM_DQ_CDC_COARSE_CAL_CFG_ADDR A:0x480844
y.create.l HWIO_DIM_D00_DIM_DQ_CDC_RSVD_CFG_ADDR A:0x480848
y.create.l HWIO_DIM_D00_DIM_DQ_RD_CDC_OFFSET_CFG_ADDR A:0x48084c
y.create.l HWIO_DIM_D00_DIM_DQ_RD_CDC_DELAY_CFG_ADDR A:0x480850
y.create.l HWIO_DIM_D00_DIM_DQ_RD_CDC_SW_MODE_CFG_ADDR A:0x480854
y.create.l HWIO_DIM_D00_DIM_DQ_RD_CDC_TEST_CFG_ADDR A:0x480858
y.create.l HWIO_DIM_D00_DIM_DQ_RD_CDC_SW_OVRD_CFG_ADDR A:0x48085c
y.create.l HWIO_DIM_D00_DIM_DQ_RD_CDC_SLAVE_DDA_CFG_ADDR A:0x480860
y.create.l HWIO_DIM_D00_DIM_DQ_RD_CDC_STATUS0_ADDR A:0x480870
y.create.l HWIO_DIM_D00_DIM_DQ_RD_CDC_STATUS1_ADDR A:0x480874
y.create.l HWIO_DIM_D00_DIM_DQ_RD_CDC_STATUS2_ADDR A:0x480878
y.create.l HWIO_DIM_D00_DIM_DQ_RD_CDC_STATUS3_ADDR A:0x48087c
y.create.l HWIO_DIM_D00_DIM_DQ_RD_CDC_STATUS4_ADDR A:0x480880
y.create.l HWIO_DIM_D00_DIM_DQ_WR_CDC_OFFSET_CFG_ADDR A:0x4808ac
y.create.l HWIO_DIM_D00_DIM_DQ_WR_CDC_DELAY_CFG_ADDR A:0x4808b0
y.create.l HWIO_DIM_D00_DIM_DQ_WR_CDC_SW_MODE_CFG_ADDR A:0x4808b4
y.create.l HWIO_DIM_D00_DIM_DQ_WR_CDC_TEST_CFG_ADDR A:0x4808b8
y.create.l HWIO_DIM_D00_DIM_DQ_WR_CDC_SW_OVRD_CFG_ADDR A:0x4808bc
y.create.l HWIO_DIM_D00_DIM_DQ_WR_CDC_STATUS0_ADDR A:0x4808d0
y.create.l HWIO_DIM_D00_DIM_DQ_WR_CDC_STATUS1_ADDR A:0x4808d4
y.create.l HWIO_DIM_D00_DIM_DQ_WR_CDC_STATUS2_ADDR A:0x4808d8
y.create.l HWIO_DIM_D00_DIM_DQ_WR_CDC_STATUS3_ADDR A:0x4808dc
y.create.l HWIO_DIM_D00_DIM_DQ_DQ_IOC_SLV_CFG_ADDR A:0x480900
y.create.l HWIO_DIM_D00_DIM_DQ_DQ_IOC_SLV_STATUS_ADDR A:0x480904
y.create.l HWIO_DIM_D00_DIM_DQ_DQS_IOC_SLV_CFG_ADDR A:0x480910
y.create.l HWIO_DIM_D00_DIM_DQ_DQS_IOC_SLV_STATUS_ADDR A:0x480914
y.create.l HWIO_DIM_D01_DIM_DQ_TOP_CFG_ADDR A:0x481000
y.create.l HWIO_DIM_D01_DIM_DQ_HW_INFO_ADDR A:0x481004
y.create.l HWIO_DIM_D01_DIM_DQ_HW_VERSION_ADDR A:0x481008
y.create.l HWIO_DIM_D01_DIM_DQ_PAD_CFG0_ADDR A:0x481010
y.create.l HWIO_DIM_D01_DIM_DQ_PAD_CFG1_ADDR A:0x481014
y.create.l HWIO_DIM_D01_DIM_DQ_PAD_CFG2_ADDR A:0x481018
y.create.l HWIO_DIM_D01_DIM_DQ_DQ_SMT_STATUS_ADDR A:0x48101c
y.create.l HWIO_DIM_D01_DIM_DQ_PAD_CFG3_ADDR A:0x481020
y.create.l HWIO_DIM_D01_DDRPHY_DQ_MISR_CFG_ADDR A:0x48100c
y.create.l HWIO_DIM_D01_DDRPHY_DQ_MISR_EVEN_STATUS_ADDR A:0x481028
y.create.l HWIO_DIM_D01_DDRPHY_DQ_MISR_ODD_STATUS_ADDR A:0x48102c
y.create.l HWIO_DIM_D01_DIM_DQ_CDC_CTLR_CFG0_ADDR A:0x481030
y.create.l HWIO_DIM_D01_DIM_DQ_CDC_CTLR_CFG1_ADDR A:0x481034
y.create.l HWIO_DIM_D01_DIM_DQ_CDC_CAL_TIMER_CFG0_ADDR A:0x481038
y.create.l HWIO_DIM_D01_DIM_DQ_CDC_CAL_TIMER_CFG1_ADDR A:0x48103c
y.create.l HWIO_DIM_D01_DIM_DQ_CDC_REFCOUNT_CFG_ADDR A:0x481040
y.create.l HWIO_DIM_D01_DIM_DQ_CDC_COARSE_CAL_CFG_ADDR A:0x481044
y.create.l HWIO_DIM_D01_DIM_DQ_CDC_RSVD_CFG_ADDR A:0x481048
y.create.l HWIO_DIM_D01_DIM_DQ_RD_CDC_OFFSET_CFG_ADDR A:0x48104c
y.create.l HWIO_DIM_D01_DIM_DQ_RD_CDC_DELAY_CFG_ADDR A:0x481050
y.create.l HWIO_DIM_D01_DIM_DQ_RD_CDC_SW_MODE_CFG_ADDR A:0x481054
y.create.l HWIO_DIM_D01_DIM_DQ_RD_CDC_TEST_CFG_ADDR A:0x481058
y.create.l HWIO_DIM_D01_DIM_DQ_RD_CDC_SW_OVRD_CFG_ADDR A:0x48105c
y.create.l HWIO_DIM_D01_DIM_DQ_RD_CDC_SLAVE_DDA_CFG_ADDR A:0x481060
y.create.l HWIO_DIM_D01_DIM_DQ_RD_CDC_STATUS0_ADDR A:0x481070
y.create.l HWIO_DIM_D01_DIM_DQ_RD_CDC_STATUS1_ADDR A:0x481074
y.create.l HWIO_DIM_D01_DIM_DQ_RD_CDC_STATUS2_ADDR A:0x481078
y.create.l HWIO_DIM_D01_DIM_DQ_RD_CDC_STATUS3_ADDR A:0x48107c
y.create.l HWIO_DIM_D01_DIM_DQ_RD_CDC_STATUS4_ADDR A:0x481080
y.create.l HWIO_DIM_D01_DIM_DQ_WR_CDC_OFFSET_CFG_ADDR A:0x4810ac
y.create.l HWIO_DIM_D01_DIM_DQ_WR_CDC_DELAY_CFG_ADDR A:0x4810b0
y.create.l HWIO_DIM_D01_DIM_DQ_WR_CDC_SW_MODE_CFG_ADDR A:0x4810b4
y.create.l HWIO_DIM_D01_DIM_DQ_WR_CDC_TEST_CFG_ADDR A:0x4810b8
y.create.l HWIO_DIM_D01_DIM_DQ_WR_CDC_SW_OVRD_CFG_ADDR A:0x4810bc
y.create.l HWIO_DIM_D01_DIM_DQ_WR_CDC_STATUS0_ADDR A:0x4810d0
y.create.l HWIO_DIM_D01_DIM_DQ_WR_CDC_STATUS1_ADDR A:0x4810d4
y.create.l HWIO_DIM_D01_DIM_DQ_WR_CDC_STATUS2_ADDR A:0x4810d8
y.create.l HWIO_DIM_D01_DIM_DQ_WR_CDC_STATUS3_ADDR A:0x4810dc
y.create.l HWIO_DIM_D01_DIM_DQ_DQ_IOC_SLV_CFG_ADDR A:0x481100
y.create.l HWIO_DIM_D01_DIM_DQ_DQ_IOC_SLV_STATUS_ADDR A:0x481104
y.create.l HWIO_DIM_D01_DIM_DQ_DQS_IOC_SLV_CFG_ADDR A:0x481110
y.create.l HWIO_DIM_D01_DIM_DQ_DQS_IOC_SLV_STATUS_ADDR A:0x481114
y.create.l HWIO_DIM_D02_DIM_DQ_TOP_CFG_ADDR A:0x481800
y.create.l HWIO_DIM_D02_DIM_DQ_HW_INFO_ADDR A:0x481804
y.create.l HWIO_DIM_D02_DIM_DQ_HW_VERSION_ADDR A:0x481808
y.create.l HWIO_DIM_D02_DIM_DQ_PAD_CFG0_ADDR A:0x481810
y.create.l HWIO_DIM_D02_DIM_DQ_PAD_CFG1_ADDR A:0x481814
y.create.l HWIO_DIM_D02_DIM_DQ_PAD_CFG2_ADDR A:0x481818
y.create.l HWIO_DIM_D02_DIM_DQ_DQ_SMT_STATUS_ADDR A:0x48181c
y.create.l HWIO_DIM_D02_DIM_DQ_PAD_CFG3_ADDR A:0x481820
y.create.l HWIO_DIM_D02_DDRPHY_DQ_MISR_CFG_ADDR A:0x48180c
y.create.l HWIO_DIM_D02_DDRPHY_DQ_MISR_EVEN_STATUS_ADDR A:0x481828
y.create.l HWIO_DIM_D02_DDRPHY_DQ_MISR_ODD_STATUS_ADDR A:0x48182c
y.create.l HWIO_DIM_D02_DIM_DQ_CDC_CTLR_CFG0_ADDR A:0x481830
y.create.l HWIO_DIM_D02_DIM_DQ_CDC_CTLR_CFG1_ADDR A:0x481834
y.create.l HWIO_DIM_D02_DIM_DQ_CDC_CAL_TIMER_CFG0_ADDR A:0x481838
y.create.l HWIO_DIM_D02_DIM_DQ_CDC_CAL_TIMER_CFG1_ADDR A:0x48183c
y.create.l HWIO_DIM_D02_DIM_DQ_CDC_REFCOUNT_CFG_ADDR A:0x481840
y.create.l HWIO_DIM_D02_DIM_DQ_CDC_COARSE_CAL_CFG_ADDR A:0x481844
y.create.l HWIO_DIM_D02_DIM_DQ_CDC_RSVD_CFG_ADDR A:0x481848
y.create.l HWIO_DIM_D02_DIM_DQ_RD_CDC_OFFSET_CFG_ADDR A:0x48184c
y.create.l HWIO_DIM_D02_DIM_DQ_RD_CDC_DELAY_CFG_ADDR A:0x481850
y.create.l HWIO_DIM_D02_DIM_DQ_RD_CDC_SW_MODE_CFG_ADDR A:0x481854
y.create.l HWIO_DIM_D02_DIM_DQ_RD_CDC_TEST_CFG_ADDR A:0x481858
y.create.l HWIO_DIM_D02_DIM_DQ_RD_CDC_SW_OVRD_CFG_ADDR A:0x48185c
y.create.l HWIO_DIM_D02_DIM_DQ_RD_CDC_SLAVE_DDA_CFG_ADDR A:0x481860
y.create.l HWIO_DIM_D02_DIM_DQ_RD_CDC_STATUS0_ADDR A:0x481870
y.create.l HWIO_DIM_D02_DIM_DQ_RD_CDC_STATUS1_ADDR A:0x481874
y.create.l HWIO_DIM_D02_DIM_DQ_RD_CDC_STATUS2_ADDR A:0x481878
y.create.l HWIO_DIM_D02_DIM_DQ_RD_CDC_STATUS3_ADDR A:0x48187c
y.create.l HWIO_DIM_D02_DIM_DQ_RD_CDC_STATUS4_ADDR A:0x481880
y.create.l HWIO_DIM_D02_DIM_DQ_WR_CDC_OFFSET_CFG_ADDR A:0x4818ac
y.create.l HWIO_DIM_D02_DIM_DQ_WR_CDC_DELAY_CFG_ADDR A:0x4818b0
y.create.l HWIO_DIM_D02_DIM_DQ_WR_CDC_SW_MODE_CFG_ADDR A:0x4818b4
y.create.l HWIO_DIM_D02_DIM_DQ_WR_CDC_TEST_CFG_ADDR A:0x4818b8
y.create.l HWIO_DIM_D02_DIM_DQ_WR_CDC_SW_OVRD_CFG_ADDR A:0x4818bc
y.create.l HWIO_DIM_D02_DIM_DQ_WR_CDC_STATUS0_ADDR A:0x4818d0
y.create.l HWIO_DIM_D02_DIM_DQ_WR_CDC_STATUS1_ADDR A:0x4818d4
y.create.l HWIO_DIM_D02_DIM_DQ_WR_CDC_STATUS2_ADDR A:0x4818d8
y.create.l HWIO_DIM_D02_DIM_DQ_WR_CDC_STATUS3_ADDR A:0x4818dc
y.create.l HWIO_DIM_D02_DIM_DQ_DQ_IOC_SLV_CFG_ADDR A:0x481900
y.create.l HWIO_DIM_D02_DIM_DQ_DQ_IOC_SLV_STATUS_ADDR A:0x481904
y.create.l HWIO_DIM_D02_DIM_DQ_DQS_IOC_SLV_CFG_ADDR A:0x481910
y.create.l HWIO_DIM_D02_DIM_DQ_DQS_IOC_SLV_STATUS_ADDR A:0x481914
y.create.l HWIO_DIM_D03_DIM_DQ_TOP_CFG_ADDR A:0x482000
y.create.l HWIO_DIM_D03_DIM_DQ_HW_INFO_ADDR A:0x482004
y.create.l HWIO_DIM_D03_DIM_DQ_HW_VERSION_ADDR A:0x482008
y.create.l HWIO_DIM_D03_DIM_DQ_PAD_CFG0_ADDR A:0x482010
y.create.l HWIO_DIM_D03_DIM_DQ_PAD_CFG1_ADDR A:0x482014
y.create.l HWIO_DIM_D03_DIM_DQ_PAD_CFG2_ADDR A:0x482018
y.create.l HWIO_DIM_D03_DIM_DQ_DQ_SMT_STATUS_ADDR A:0x48201c
y.create.l HWIO_DIM_D03_DIM_DQ_PAD_CFG3_ADDR A:0x482020
y.create.l HWIO_DIM_D03_DDRPHY_DQ_MISR_CFG_ADDR A:0x48200c
y.create.l HWIO_DIM_D03_DDRPHY_DQ_MISR_EVEN_STATUS_ADDR A:0x482028
y.create.l HWIO_DIM_D03_DDRPHY_DQ_MISR_ODD_STATUS_ADDR A:0x48202c
y.create.l HWIO_DIM_D03_DIM_DQ_CDC_CTLR_CFG0_ADDR A:0x482030
y.create.l HWIO_DIM_D03_DIM_DQ_CDC_CTLR_CFG1_ADDR A:0x482034
y.create.l HWIO_DIM_D03_DIM_DQ_CDC_CAL_TIMER_CFG0_ADDR A:0x482038
y.create.l HWIO_DIM_D03_DIM_DQ_CDC_CAL_TIMER_CFG1_ADDR A:0x48203c
y.create.l HWIO_DIM_D03_DIM_DQ_CDC_REFCOUNT_CFG_ADDR A:0x482040
y.create.l HWIO_DIM_D03_DIM_DQ_CDC_COARSE_CAL_CFG_ADDR A:0x482044
y.create.l HWIO_DIM_D03_DIM_DQ_CDC_RSVD_CFG_ADDR A:0x482048
y.create.l HWIO_DIM_D03_DIM_DQ_RD_CDC_OFFSET_CFG_ADDR A:0x48204c
y.create.l HWIO_DIM_D03_DIM_DQ_RD_CDC_DELAY_CFG_ADDR A:0x482050
y.create.l HWIO_DIM_D03_DIM_DQ_RD_CDC_SW_MODE_CFG_ADDR A:0x482054
y.create.l HWIO_DIM_D03_DIM_DQ_RD_CDC_TEST_CFG_ADDR A:0x482058
y.create.l HWIO_DIM_D03_DIM_DQ_RD_CDC_SW_OVRD_CFG_ADDR A:0x48205c
y.create.l HWIO_DIM_D03_DIM_DQ_RD_CDC_SLAVE_DDA_CFG_ADDR A:0x482060
y.create.l HWIO_DIM_D03_DIM_DQ_RD_CDC_STATUS0_ADDR A:0x482070
y.create.l HWIO_DIM_D03_DIM_DQ_RD_CDC_STATUS1_ADDR A:0x482074
y.create.l HWIO_DIM_D03_DIM_DQ_RD_CDC_STATUS2_ADDR A:0x482078
y.create.l HWIO_DIM_D03_DIM_DQ_RD_CDC_STATUS3_ADDR A:0x48207c
y.create.l HWIO_DIM_D03_DIM_DQ_RD_CDC_STATUS4_ADDR A:0x482080
y.create.l HWIO_DIM_D03_DIM_DQ_WR_CDC_OFFSET_CFG_ADDR A:0x4820ac
y.create.l HWIO_DIM_D03_DIM_DQ_WR_CDC_DELAY_CFG_ADDR A:0x4820b0
y.create.l HWIO_DIM_D03_DIM_DQ_WR_CDC_SW_MODE_CFG_ADDR A:0x4820b4
y.create.l HWIO_DIM_D03_DIM_DQ_WR_CDC_TEST_CFG_ADDR A:0x4820b8
y.create.l HWIO_DIM_D03_DIM_DQ_WR_CDC_SW_OVRD_CFG_ADDR A:0x4820bc
y.create.l HWIO_DIM_D03_DIM_DQ_WR_CDC_STATUS0_ADDR A:0x4820d0
y.create.l HWIO_DIM_D03_DIM_DQ_WR_CDC_STATUS1_ADDR A:0x4820d4
y.create.l HWIO_DIM_D03_DIM_DQ_WR_CDC_STATUS2_ADDR A:0x4820d8
y.create.l HWIO_DIM_D03_DIM_DQ_WR_CDC_STATUS3_ADDR A:0x4820dc
y.create.l HWIO_DIM_D03_DIM_DQ_DQ_IOC_SLV_CFG_ADDR A:0x482100
y.create.l HWIO_DIM_D03_DIM_DQ_DQ_IOC_SLV_STATUS_ADDR A:0x482104
y.create.l HWIO_DIM_D03_DIM_DQ_DQS_IOC_SLV_CFG_ADDR A:0x482110
y.create.l HWIO_DIM_D03_DIM_DQ_DQS_IOC_SLV_STATUS_ADDR A:0x482114
y.create.l HWIO_EBI1_HW_VERSION_ADDR A:0x49f000
y.create.l HWIO_EBI1_HW_INFO_ADDR A:0x49f004
y.create.l HWIO_EBI1_AHB2PHY_BROADCAST_EN_CFG_LOWER_ADDR A:0x49f008
y.create.l HWIO_EBI1_AHB2PHY_BROADCAST_EN_CFG_UPPER_ADDR A:0x49f00c
y.create.l HWIO_EBI1_AHB2PHY_TOP_CFG_ADDR A:0x49f010
y.create.l HWIO_EBI1_AHB2PHY_DEBUG_BUS_CFG_ADDR A:0x49f014
y.create.l HWIO_EBI1_AHB2PHY_BROADCAST_ADDRESS_SPACE_0_ADDR A:0x49f800
y.create.l HWIO_EBI1_AHB2PHY_BROADCAST_ADDRESS_SPACE_1_ADDR A:0x49f804
y.create.l HWIO_EBI1_AHB2PHY_BROADCAST_ADDRESS_SPACE_2_ADDR A:0x49f808
y.create.l HWIO_EBI1_AHB2PHY_BROADCAST_ADDRESS_SPACE_3_ADDR A:0x49f80c
y.create.l HWIO_EBI1_AHB2PHY_BROADCAST_ADDRESS_SPACE_4_ADDR A:0x49f810
y.create.l HWIO_EBI1_AHB2PHY_BROADCAST_ADDRESS_SPACE_5_ADDR A:0x49f814
y.create.l HWIO_EBI1_AHB2PHY_BROADCAST_ADDRESS_SPACE_6_ADDR A:0x49f818
y.create.l HWIO_EBI1_AHB2PHY_BROADCAST_ADDRESS_SPACE_7_ADDR A:0x49f81c
y.create.l HWIO_EBI1_AHB2PHY_BROADCAST_ADDRESS_SPACE_8_ADDR A:0x49f820
y.create.l HWIO_EBI1_AHB2PHY_BROADCAST_ADDRESS_SPACE_9_ADDR A:0x49f824
y.create.l HWIO_EMAC_0_EMAC_DMA_MAS_CTRL_ADDR A:0x7c41400
y.create.l HWIO_EMAC_0_EMAC_TIMER_INIT_VALUE_ADDR A:0x7c41404
y.create.l HWIO_EMAC_0_EMAC_IRQ_MOD_TIM_INIT_ADDR A:0x7c41408
y.create.l HWIO_EMAC_0_EMAC_BLK_IDLE_STS_ADDR A:0x7c4140c
y.create.l HWIO_EMAC_0_EMAC_MDIO_CTRL_ADDR A:0x7c41414
y.create.l HWIO_EMAC_0_EMAC_PHY_STS_ADDR A:0x7c41418
y.create.l HWIO_EMAC_0_EMAC_PHY_LINK_DELAY_ADDR A:0x7c4141c
y.create.l HWIO_EMAC_0_EMAC_SYS_ALIV_CTRL_ADDR A:0x7c41434
y.create.l HWIO_EMAC_0_EMAC_MDIO_EX_CTRL_ADDR A:0x7c41440
y.create.l HWIO_EMAC_0_EMAC_MAC_CTRL_ADDR A:0x7c41480
y.create.l HWIO_EMAC_0_EMAC_MAC_IPGIFG_CTRL_ADDR A:0x7c41484
y.create.l HWIO_EMAC_0_EMAC_MAC_STA_ADDR0_ADDR A:0x7c41488
y.create.l HWIO_EMAC_0_EMAC_MAC_STA_ADDR1_ADDR A:0x7c4148c
y.create.l HWIO_EMAC_0_EMAC_HASH_TAB_REG0_ADDR A:0x7c41490
y.create.l HWIO_EMAC_0_EMAC_HASH_TAB_REG1_ADDR A:0x7c41494
y.create.l HWIO_EMAC_0_EMAC_MAC_HALF_DPLX_CTRL_ADDR A:0x7c41498
y.create.l HWIO_EMAC_0_EMAC_MAX_FRAM_LEN_CTRL_ADDR A:0x7c4149c
y.create.l HWIO_EMAC_0_EMAC_WOL_CTRL0_ADDR A:0x7c414a0
y.create.l HWIO_EMAC_0_EMAC_WOL_CTRL1_ADDR A:0x7c414a4
y.create.l HWIO_EMAC_0_EMAC_WOL_CTRL2_ADDR A:0x7c414a8
y.create.l HWIO_EMAC_0_EMAC_RSS_KEY0_ADDR A:0x7c414b0
y.create.l HWIO_EMAC_0_EMAC_RSS_KEY1_ADDR A:0x7c414b4
y.create.l HWIO_EMAC_0_EMAC_RSS_KEY2_ADDR A:0x7c414b8
y.create.l HWIO_EMAC_0_EMAC_RSS_KEY3_ADDR A:0x7c414bc
y.create.l HWIO_EMAC_0_EMAC_RSS_KEY4_ADDR A:0x7c414c0
y.create.l HWIO_EMAC_0_EMAC_RSS_KEY5_ADDR A:0x7c414c4
y.create.l HWIO_EMAC_0_EMAC_RSS_KEY6_ADDR A:0x7c414c8
y.create.l HWIO_EMAC_0_EMAC_RSS_KEY7_ADDR A:0x7c414cc
y.create.l HWIO_EMAC_0_EMAC_RSS_KEY8_ADDR A:0x7c414d0
y.create.l HWIO_EMAC_0_EMAC_RSS_KEY9_ADDR A:0x7c414d4
y.create.l HWIO_EMAC_0_EMAC_H1TPD_BASE_ADDR_LO_ADDR A:0x7c414e0
y.create.l HWIO_EMAC_0_EMAC_H2TPD_BASE_ADDR_LO_ADDR A:0x7c414e4
y.create.l HWIO_EMAC_0_EMAC_H3TPD_BASE_ADDR_LO_ADDR A:0x7c414e8
y.create.l HWIO_EMAC_0_EMAC_INTER_SRAM_PART0_ADDR A:0x7c41500
y.create.l HWIO_EMAC_0_EMAC_INTER_SRAM_PART10_ADDR A:0x7c41504
y.create.l HWIO_EMAC_0_EMAC_INTER_SRAM_PART11_ADDR A:0x7c41508
y.create.l HWIO_EMAC_0_EMAC_INTER_SRAM_PART12_ADDR A:0x7c4150c
y.create.l HWIO_EMAC_0_EMAC_INTER_SRAM_PART1_ADDR A:0x7c41510
y.create.l HWIO_EMAC_0_EMAC_INTER_SRAM_PART2_ADDR A:0x7c41518
y.create.l HWIO_EMAC_0_EMAC_INTER_SRAM_PART3_ADDR A:0x7c4151c
y.create.l HWIO_EMAC_0_EMAC_INTER_SRAM_PART4_ADDR A:0x7c41520
y.create.l HWIO_EMAC_0_EMAC_INTER_SRAM_PART5_ADDR A:0x7c41524
y.create.l HWIO_EMAC_0_EMAC_INTER_SRAM_PART6_ADDR A:0x7c41528
y.create.l HWIO_EMAC_0_EMAC_INTER_SRAM_PART7_ADDR A:0x7c4152c
y.create.l HWIO_EMAC_0_EMAC_INTER_SRAM_PART8_ADDR A:0x7c41530
y.create.l HWIO_EMAC_0_EMAC_INTER_SRAM_PART9_ADDR A:0x7c41534
y.create.l HWIO_EMAC_0_EMAC_DESC_CTRL_0_ADDR A:0x7c41540
y.create.l HWIO_EMAC_0_EMAC_DESC_CTRL_1_ADDR A:0x7c41544
y.create.l HWIO_EMAC_0_EMAC_DESC_CTRL_2_ADDR A:0x7c41550
y.create.l HWIO_EMAC_0_EMAC_DESC_CTRL_10_ADDR A:0x7c41554
y.create.l HWIO_EMAC_0_EMAC_DESC_CTRL_12_ADDR A:0x7c41558
y.create.l HWIO_EMAC_0_EMAC_DESC_CTRL_13_ADDR A:0x7c4155c
y.create.l HWIO_EMAC_0_EMAC_DESC_CTRL_3_ADDR A:0x7c41560
y.create.l HWIO_EMAC_0_EMAC_DESC_CTRL_4_ADDR A:0x7c41564
y.create.l HWIO_EMAC_0_EMAC_DESC_CTRL_5_ADDR A:0x7c41568
y.create.l HWIO_EMAC_0_EMAC_DESC_CTRL_14_ADDR A:0x7c4156c
y.create.l HWIO_EMAC_0_EMAC_DESC_CTRL_15_ADDR A:0x7c41570
y.create.l HWIO_EMAC_0_EMAC_DESC_CTRL_16_ADDR A:0x7c41574
y.create.l HWIO_EMAC_0_EMAC_DESC_CTRL_6_ADDR A:0x7c41578
y.create.l HWIO_EMAC_0_EMAC_DESC_CTRL_7_ADDR A:0x7c4157c
y.create.l HWIO_EMAC_0_EMAC_DESC_CTRL_8_ADDR A:0x7c41580
y.create.l HWIO_EMAC_0_EMAC_DESC_CTRL_9_ADDR A:0x7c41584
y.create.l HWIO_EMAC_0_EMAC_DESC_CTRL_11_ADDR A:0x7c41588
y.create.l HWIO_EMAC_0_EMAC_TXQ_CTRL_0_ADDR A:0x7c41590
y.create.l HWIO_EMAC_0_EMAC_TXQ_CTRL_1_ADDR A:0x7c41594
y.create.l HWIO_EMAC_0_EMAC_TXQ_CTRL_2_ADDR A:0x7c41598
y.create.l HWIO_EMAC_0_EMAC_RXQ_CTRL_0_ADDR A:0x7c415a0
y.create.l HWIO_EMAC_0_EMAC_RXQ_CTRL_1_ADDR A:0x7c415a4
y.create.l HWIO_EMAC_0_EMAC_RXQ_CTRL_2_ADDR A:0x7c415a8
y.create.l HWIO_EMAC_0_EMAC_RXQ_CTRL_3_ADDR A:0x7c415ac
y.create.l HWIO_EMAC_0_EMAC_RSS_HASH_VALUE_ADDR A:0x7c415b0
y.create.l HWIO_EMAC_0_EMAC_RSS_HASH_FLAG_ADDR A:0x7c415b4
y.create.l HWIO_EMAC_0_EMAC_BASE_CPU_NUMBER_ADDR A:0x7c415b8
y.create.l HWIO_EMAC_0_EMAC_DMA_CTRL_ADDR A:0x7c415c0
y.create.l HWIO_EMAC_0_EMAC_MAILBOX_14_ADDR A:0x7c415dc
y.create.l HWIO_EMAC_0_EMAC_MAILBOX_0_ADDR A:0x7c415e0
y.create.l HWIO_EMAC_0_EMAC_MAILBOX_5_ADDR A:0x7c415e4
y.create.l HWIO_EMAC_0_EMAC_MAILBOX_6_ADDR A:0x7c415e8
y.create.l HWIO_EMAC_0_EMAC_MAILBOX_13_ADDR A:0x7c415ec
y.create.l HWIO_EMAC_0_EMAC_MAILBOX_1_ADDR A:0x7c415f0
y.create.l HWIO_EMAC_0_EMAC_MAILBOX_2_ADDR A:0x7c415f4
y.create.l HWIO_EMAC_0_EMAC_MAILBOX_3_ADDR A:0x7c415f8
y.create.l HWIO_EMAC_0_EMAC_MAILBOX_4_ADDR A:0x7c415fc
y.create.l HWIO_EMAC_0_EMAC_INT_STATUS_ADDR A:0x7c41600
y.create.l HWIO_EMAC_0_EMAC_INT_MASK_ADDR A:0x7c41604
y.create.l HWIO_EMAC_0_EMAC_INT_RETRIG_INIT_ADDR A:0x7c41608
y.create.l HWIO_EMAC_0_EMAC_MAILBOX_11_ADDR A:0x7c4160c
y.create.l HWIO_EMAC_0_EMAC_AXI_MAST_CTRL_ADDR A:0x7c41610
y.create.l HWIO_EMAC_0_EMAC_MAILBOX_12_ADDR A:0x7c41614
y.create.l HWIO_EMAC_0_EMAC_MAILBOX_9_ADDR A:0x7c41618
y.create.l HWIO_EMAC_0_EMAC_MAILBOX_10_ADDR A:0x7c4161c
y.create.l HWIO_EMAC_0_EMAC_ATHR_HEADER_CTRL_ADDR A:0x7c41620
y.create.l HWIO_EMAC_0_EMAC_VLAN_TPD_CFIG_ADDR A:0x7c41624
y.create.l HWIO_EMAC_0_EMAC_RXMAC_STATC_REG0_ADDR A:0x7c41700
y.create.l HWIO_EMAC_0_EMAC_RXMAC_STATC_REG1_ADDR A:0x7c41704
y.create.l HWIO_EMAC_0_EMAC_RXMAC_STATC_REG2_ADDR A:0x7c41708
y.create.l HWIO_EMAC_0_EMAC_RXMAC_STATC_REG3_ADDR A:0x7c4170c
y.create.l HWIO_EMAC_0_EMAC_RXMAC_STATC_REG4_ADDR A:0x7c41710
y.create.l HWIO_EMAC_0_EMAC_RXMAC_STATC_REG5_ADDR A:0x7c41714
y.create.l HWIO_EMAC_0_EMAC_RXMAC_STATC_REG6_ADDR A:0x7c41718
y.create.l HWIO_EMAC_0_EMAC_RXMAC_STATC_REG7_ADDR A:0x7c4171c
y.create.l HWIO_EMAC_0_EMAC_RXMAC_STATC_REG8_ADDR A:0x7c41720
y.create.l HWIO_EMAC_0_EMAC_RXMAC_STATC_REG9_ADDR A:0x7c41724
y.create.l HWIO_EMAC_0_EMAC_RXMAC_STATC_REG10_ADDR A:0x7c41728
y.create.l HWIO_EMAC_0_EMAC_RXMAC_STATC_REG11_ADDR A:0x7c4172c
y.create.l HWIO_EMAC_0_EMAC_RXMAC_STATC_REG12_ADDR A:0x7c41730
y.create.l HWIO_EMAC_0_EMAC_RXMAC_STATC_REG13_ADDR A:0x7c41734
y.create.l HWIO_EMAC_0_EMAC_RXMAC_STATC_REG14_ADDR A:0x7c41738
y.create.l HWIO_EMAC_0_EMAC_RXMAC_STATC_REG15_ADDR A:0x7c4173c
y.create.l HWIO_EMAC_0_EMAC_RXMAC_STATC_REG16_ADDR A:0x7c41740
y.create.l HWIO_EMAC_0_EMAC_RXMAC_STATC_REG17_ADDR A:0x7c41744
y.create.l HWIO_EMAC_0_EMAC_RXMAC_STATC_REG18_ADDR A:0x7c41748
y.create.l HWIO_EMAC_0_EMAC_RXMAC_STATC_REG19_ADDR A:0x7c4174c
y.create.l HWIO_EMAC_0_EMAC_RXMAC_STATC_REG20_ADDR A:0x7c41750
y.create.l HWIO_EMAC_0_EMAC_RXMAC_STATC_REG21_ADDR A:0x7c41754
y.create.l HWIO_EMAC_0_EMAC_RXMAC_STATC_REG22_ADDR A:0x7c41758
y.create.l HWIO_EMAC_0_EMAC_TXMAC_STATC_REG0_ADDR A:0x7c41760
y.create.l HWIO_EMAC_0_EMAC_TXMAC_STATC_REG1_ADDR A:0x7c41764
y.create.l HWIO_EMAC_0_EMAC_TXMAC_STATC_REG2_ADDR A:0x7c41768
y.create.l HWIO_EMAC_0_EMAC_TXMAC_STATC_REG3_ADDR A:0x7c4176c
y.create.l HWIO_EMAC_0_EMAC_TXMAC_STATC_REG4_ADDR A:0x7c41770
y.create.l HWIO_EMAC_0_EMAC_TXMAC_STATC_REG5_ADDR A:0x7c41774
y.create.l HWIO_EMAC_0_EMAC_TXMAC_STATC_REG6_ADDR A:0x7c41778
y.create.l HWIO_EMAC_0_EMAC_TXMAC_STATC_REG7_ADDR A:0x7c4177c
y.create.l HWIO_EMAC_0_EMAC_TXMAC_STATC_REG8_ADDR A:0x7c41780
y.create.l HWIO_EMAC_0_EMAC_TXMAC_STATC_REG9_ADDR A:0x7c41784
y.create.l HWIO_EMAC_0_EMAC_TXMAC_STATC_REG10_ADDR A:0x7c41788
y.create.l HWIO_EMAC_0_EMAC_TXMAC_STATC_REG11_ADDR A:0x7c4178c
y.create.l HWIO_EMAC_0_EMAC_TXMAC_STATC_REG12_ADDR A:0x7c41790
y.create.l HWIO_EMAC_0_EMAC_TXMAC_STATC_REG13_ADDR A:0x7c41794
y.create.l HWIO_EMAC_0_EMAC_TXMAC_STATC_REG14_ADDR A:0x7c41798
y.create.l HWIO_EMAC_0_EMAC_TXMAC_STATC_REG15_ADDR A:0x7c4179c
y.create.l HWIO_EMAC_0_EMAC_TXMAC_STATC_REG16_ADDR A:0x7c417a0
y.create.l HWIO_EMAC_0_EMAC_TXMAC_STATC_REG17_ADDR A:0x7c417a4
y.create.l HWIO_EMAC_0_EMAC_TXMAC_STATC_REG18_ADDR A:0x7c417a8
y.create.l HWIO_EMAC_0_EMAC_TXMAC_STATC_REG19_ADDR A:0x7c417ac
y.create.l HWIO_EMAC_0_EMAC_TXMAC_STATC_REG20_ADDR A:0x7c417b0
y.create.l HWIO_EMAC_0_EMAC_TXMAC_STATC_REG21_ADDR A:0x7c417b4
y.create.l HWIO_EMAC_0_EMAC_TXMAC_STATC_REG22_ADDR A:0x7c417b8
y.create.l HWIO_EMAC_0_EMAC_TXMAC_STATC_REG23_ADDR A:0x7c417bc
y.create.l HWIO_EMAC_0_EMAC_TXMAC_STATC_REG24_ADDR A:0x7c417c0
y.create.l HWIO_EMAC_0_EMAC_SW_CTRL_0_ADDR A:0x7c41800
y.create.l HWIO_EMAC_0_EMAC_SW_CTRL_1_ADDR A:0x7c41804
y.create.l HWIO_EMAC_0_EMAC_SW_CTRL_2_ADDR A:0x7c41808
y.create.l HWIO_EMAC_0_EMAC_SW_CTRL_3_ADDR A:0x7c4180c
y.create.l HWIO_EMAC_0_EMAC_CLK_GATE_CTRL_ADDR A:0x7c41814
y.create.l HWIO_EMAC_0_EMAC_DBG_CTRL_ADDR A:0x7c41900
y.create.l HWIO_EMAC_0_EMAC_DBG_DATA_ADDR A:0x7c41904
y.create.l HWIO_EMAC_0_EMAC_WEIGHT_RR_ADDR A:0x7c41938
y.create.l HWIO_EMAC_0_EMAC_TPD_CTRL_ADDR A:0x7c4193c
y.create.l HWIO_EMAC_0_EMAC_ROUND_NUMBER_CTRL_ADDR A:0x7c41940
y.create.l HWIO_EMAC_0_EMAC_CORE_HW_VERSION_ADDR A:0x7c41974
y.create.l HWIO_EMAC_0_EMAC_MISC_CTRL_ADDR A:0x7c41990
y.create.l HWIO_EMAC_0_EMAC_MAILBOX_7_ADDR A:0x7c419e0
y.create.l HWIO_EMAC_0_EMAC_MAILBOX_8_ADDR A:0x7c419e4
y.create.l HWIO_EMAC_0_EMAC_DESC_CTRL_17_ADDR A:0x7c419f0
y.create.l HWIO_EMAC_0_EMAC_DESC_CTRL_18_ADDR A:0x7c419f4
y.create.l HWIO_EMAC_0_EMAC_INTER_SRAM_PART13_ADDR A:0x7c419f8
y.create.l HWIO_EMAC_0_EMAC_IDT_TABLE0_ADDR A:0x7c41b00
y.create.l HWIO_EMAC_0_EMAC_IDT_TABLE1_ADDR A:0x7c41b04
y.create.l HWIO_EMAC_0_EMAC_IDT_TABLE2_ADDR A:0x7c41b08
y.create.l HWIO_EMAC_0_EMAC_IDT_TABLE3_ADDR A:0x7c41b0c
y.create.l HWIO_EMAC_0_EMAC_IDT_TABLE4_ADDR A:0x7c41b10
y.create.l HWIO_EMAC_0_EMAC_IDT_TABLE5_ADDR A:0x7c41b14
y.create.l HWIO_EMAC_0_EMAC_IDT_TABLE6_ADDR A:0x7c41b18
y.create.l HWIO_EMAC_0_EMAC_IDT_TABLE7_ADDR A:0x7c41b1c
y.create.l HWIO_EMAC_0_EMAC_IDT_TABLE8_ADDR A:0x7c41b20
y.create.l HWIO_EMAC_0_EMAC_IDT_TABLE9_ADDR A:0x7c41b24
y.create.l HWIO_EMAC_0_EMAC_IDT_TABLE10_ADDR A:0x7c41b28
y.create.l HWIO_EMAC_0_EMAC_IDT_TABLE11_ADDR A:0x7c41b2c
y.create.l HWIO_EMAC_0_EMAC_IDT_TABLE12_ADDR A:0x7c41b30
y.create.l HWIO_EMAC_0_EMAC_IDT_TABLE13_ADDR A:0x7c41b34
y.create.l HWIO_EMAC_0_EMAC_IDT_TABLE14_ADDR A:0x7c41b38
y.create.l HWIO_EMAC_0_EMAC_IDT_TABLE15_ADDR A:0x7c41b3c
y.create.l HWIO_EMAC_0_EMAC_IDT_TABLE16_ADDR A:0x7c41b40
y.create.l HWIO_EMAC_0_EMAC_IDT_TABLE17_ADDR A:0x7c41b44
y.create.l HWIO_EMAC_0_EMAC_IDT_TABLE18_ADDR A:0x7c41b48
y.create.l HWIO_EMAC_0_EMAC_IDT_TABLE19_ADDR A:0x7c41b4c
y.create.l HWIO_EMAC_0_EMAC_IDT_TABLE20_ADDR A:0x7c41b50
y.create.l HWIO_EMAC_0_EMAC_IDT_TABLE21_ADDR A:0x7c41b54
y.create.l HWIO_EMAC_0_EMAC_IDT_TABLE22_ADDR A:0x7c41b58
y.create.l HWIO_EMAC_0_EMAC_IDT_TABLE23_ADDR A:0x7c41b5c
y.create.l HWIO_EMAC_0_EMAC_IDT_TABLE24_ADDR A:0x7c41b60
y.create.l HWIO_EMAC_0_EMAC_IDT_TABLE25_ADDR A:0x7c41b64
y.create.l HWIO_EMAC_0_EMAC_IDT_TABLE26_ADDR A:0x7c41b68
y.create.l HWIO_EMAC_0_EMAC_IDT_TABLE27_ADDR A:0x7c41b6c
y.create.l HWIO_EMAC_0_EMAC_IDT_TABLE28_ADDR A:0x7c41b70
y.create.l HWIO_EMAC_0_EMAC_IDT_TABLE29_ADDR A:0x7c41b74
y.create.l HWIO_EMAC_0_EMAC_IDT_TABLE30_ADDR A:0x7c41b78
y.create.l HWIO_EMAC_0_EMAC_IDT_TABLE31_ADDR A:0x7c41b7c
y.create.l HWIO_EMAC_0_EMAC_VMQ_FILTER0_LO_ADDR A:0x7c41b80
y.create.l HWIO_EMAC_0_EMAC_VMQ_FILTER0_HI_ADDR A:0x7c41b84
y.create.l HWIO_EMAC_0_EMAC_VMQ_FILTER1_LO_ADDR A:0x7c41b88
y.create.l HWIO_EMAC_0_EMAC_VMQ_FILTER1_HI_ADDR A:0x7c41b8c
y.create.l HWIO_EMAC_0_EMAC_VMQ_FILTER2_LO_ADDR A:0x7c41b90
y.create.l HWIO_EMAC_0_EMAC_VMQ_FILTER2_HI_ADDR A:0x7c41b94
y.create.l HWIO_EMAC_0_EMAC_VMQ_FILTER3_LO_ADDR A:0x7c41b98
y.create.l HWIO_EMAC_0_EMAC_VMQ_FILTER3_HI_ADDR A:0x7c41b9c
y.create.l HWIO_EMAC_0_EMAC_VMQ_FILTER4_LO_ADDR A:0x7c41ba0
y.create.l HWIO_EMAC_0_EMAC_VMQ_FILTER4_HI_ADDR A:0x7c41ba4
y.create.l HWIO_EMAC_0_EMAC_VMQ_FILTER5_LO_ADDR A:0x7c41ba8
y.create.l HWIO_EMAC_0_EMAC_VMQ_FILTER5_HI_ADDR A:0x7c41bac
y.create.l HWIO_EMAC_0_EMAC_VMQ_FILTER6_LO_ADDR A:0x7c41bb0
y.create.l HWIO_EMAC_0_EMAC_VMQ_FILTER6_HI_ADDR A:0x7c41bb4
y.create.l HWIO_EMAC_0_EMAC_VMQ_FILTER7_LO_ADDR A:0x7c41bb8
y.create.l HWIO_EMAC_0_EMAC_VMQ_FILTER7_HI_ADDR A:0x7c41bbc
y.create.l HWIO_EMAC_0_EMAC_VMQ_FILTER_MAP_ADDR A:0x7c41bc0
y.create.l HWIO_EMAC_0_EMAC_VMQ_FILTER_EN_CTRL_ADDR A:0x7c41bc4
y.create.l HWIO_EMAC_0_EMAC_RXMAC_STATC_REG23_ADDR A:0x7c41bc8
y.create.l HWIO_EMAC_0_EMAC_RXMAC_STATC_REG24_ADDR A:0x7c41bcc
y.create.l HWIO_EMAC_0_EMAC_TXMAC_STATC_REG25_ADDR A:0x7c41bd0
y.create.l HWIO_EMAC_0_EMAC_MAILBOX_15_ADDR A:0x7c41bd4
y.create.l HWIO_EMAC_0_EMAC_MAILBOX_16_ADDR A:0x7c41bd8
y.create.l HWIO_EMAC_0_EMAC_TXMAC_STATC_REG26_ADDR A:0x7c41bdc
y.create.l HWIO_EMAC_0_EMAC_TXMAC_STATC_REG27_ADDR A:0x7c41be0
y.create.l HWIO_EMAC_0_EMAC_TXMAC_STATC_REG28_ADDR A:0x7c41be4
y.create.l HWIO_EMAC_0_EMAC_TXMAC_STATC_REG29_ADDR A:0x7c41be8
y.create.l HWIO_EMAC_0_EMAC_TXMAC_STATC_REG30_ADDR A:0x7c41bec
y.create.l HWIO_EMAC_0_EMAC_INT1_MASK_ADDR A:0x7c41bf0
y.create.l HWIO_EMAC_0_EMAC_INT1_STATUS_ADDR A:0x7c41bf4
y.create.l HWIO_EMAC_0_EMAC_INT2_MASK_ADDR A:0x7c41bf8
y.create.l HWIO_EMAC_0_EMAC_INT2_STATUS_ADDR A:0x7c41bfc
y.create.l HWIO_EMAC_0_EMAC_INT3_MASK_ADDR A:0x7c41c00
y.create.l HWIO_EMAC_0_EMAC_INT3_STATUS_ADDR A:0x7c41c04
y.create.l HWIO_EMAC_0_EMAC_EMAC_RAM0_ADDR A:0x7c48000
y.create.l HWIO_EMAC_0_EMAC_EMAC_RAM1_ADDR A:0x7c48004
y.create.l HWIO_EMAC_0_EMAC_EMAC_RAM2_ADDR A:0x7c48008
y.create.l HWIO_EMAC_0_EMAC_EMAC_RAM3_ADDR A:0x7c4800c
y.create.l HWIO_EMAC_0_EMAC_EMAC_RAM4_ADDR A:0x7c48010
y.create.l HWIO_EMAC_0_EMAC_EMAC_RAM5_ADDR A:0x7c48014
y.create.l HWIO_EMAC_0_EMAC_EMAC_RAM6_ADDR A:0x7c48018
y.create.l HWIO_EMAC_0_EMAC_EMAC_RAM7_ADDR A:0x7c4801c
y.create.l HWIO_EMAC_0_EMAC_EMAC_RAM8_ADDR A:0x7c48020
y.create.l HWIO_EMAC_0_EMAC_EMAC_RAM9_ADDR A:0x7c48024
y.create.l HWIO_EMAC_0_EMAC_EMAC_WRAPPER_CSR1_ADDR A:0x7c56000
y.create.l HWIO_EMAC_0_EMAC_EMAC_WRAPPER_CSR2_ADDR A:0x7c56004
y.create.l HWIO_EMAC_0_EMAC_EMAC_WRAPPER_CSR3_ADDR A:0x7c56008
y.create.l HWIO_EMAC_0_EMAC_EMAC_WRAPPER_CSR4_ADDR A:0x7c5600c
y.create.l HWIO_EMAC_0_EMAC_EMAC_WRAPPER_CSR5_ADDR A:0x7c56010
y.create.l HWIO_EMAC_0_EMAC_EMAC_WRAPPER_CSR6_ADDR A:0x7c56014
y.create.l HWIO_EMAC_0_EMAC_EMAC_WRAPPER_CSR7_ADDR A:0x7c56018
y.create.l HWIO_EMAC_0_EMAC_EMAC_WRAPPER_CSR8_ADDR A:0x7c5601c
y.create.l HWIO_EMAC_0_EMAC_EMAC_WRAPPER_CSR9_ADDR A:0x7c56020
y.create.l HWIO_EMAC_0_EMAC_EMAC_WRAPPER_CSR10_ADDR A:0x7c56024
y.create.l HWIO_EMAC_0_EMAC_EMAC_WRAPPER_CSR11_ADDR A:0x7c56028
y.create.l HWIO_EMAC_0_EMAC_EMAC_WRAPPER_CSR12_ADDR A:0x7c5602c
y.create.l HWIO_EMAC_0_EMAC_EMAC_WRAPPER_CSR13_ADDR A:0x7c56030
y.create.l HWIO_EMAC_0_EMAC_EMAC_WRAPPER_CSR14_ADDR A:0x7c56034
y.create.l HWIO_EMAC_0_EMAC_EMAC_WRAPPER_CSR15_ADDR A:0x7c56038
y.create.l HWIO_EMAC_0_EMAC_EMAC_WRAPPER_CSR16_ADDR A:0x7c5603c
y.create.l HWIO_EMAC_0_EMAC_EMAC_WRAPPER_CSR17_ADDR A:0x7c56040
y.create.l HWIO_EMAC_0_EMAC_EMAC_WRAPPER_CSR18_ADDR A:0x7c56044
y.create.l HWIO_EMAC_0_EMAC_EMAC_WRAPPER_CSR19_ADDR A:0x7c56048
y.create.l HWIO_EMAC_0_EMAC_EMAC_WRAPPER_STATUS_ADDR A:0x7c56100
y.create.l HWIO_EMAC_0_EMAC_EMAC_WRAPPER_TX_TS_LO_ADDR A:0x7c56104
y.create.l HWIO_EMAC_0_EMAC_EMAC_WRAPPER_TX_TS_HI_ADDR A:0x7c56108
y.create.l HWIO_EMAC_0_EMAC_EMAC_WRAPPER_TX_TS_INX_ADDR A:0x7c5610c
y.create.l HWIO_EMAC_0_EMAC_EMAC_WRAPPER_IRQ_STATUS_ADDR A:0x7c56110
y.create.l HWIO_EMAC_0_EMAC_P1588_CTRL_REG_ADDR A:0x7c5c048
y.create.l HWIO_EMAC_0_EMAC_P1588_RX_SEQUENCE_ID_ADDR A:0x7c5c04c
y.create.l HWIO_EMAC_0_EMAC_P1588_RX_SRC_PORT_ID_5_ADDR A:0x7c5c050
y.create.l HWIO_EMAC_0_EMAC_P1588_RX_SRC_PORT_ID_4_ADDR A:0x7c5c054
y.create.l HWIO_EMAC_0_EMAC_P1588_RX_SRC_PORT_ID_3_ADDR A:0x7c5c058
y.create.l HWIO_EMAC_0_EMAC_P1588_RX_SRC_PORT_ID_2_ADDR A:0x7c5c05c
y.create.l HWIO_EMAC_0_EMAC_P1588_RX_SRC_PORT_ID_1_ADDR A:0x7c5c060
y.create.l HWIO_EMAC_0_EMAC_P1588_RX_TIME_STAMP_5_ADDR A:0x7c5c064
y.create.l HWIO_EMAC_0_EMAC_P1588_RX_TIME_STAMP_4_ADDR A:0x7c5c068
y.create.l HWIO_EMAC_0_EMAC_P1588_RX_TIME_STAMP_3_ADDR A:0x7c5c06c
y.create.l HWIO_EMAC_0_EMAC_P1588_RX_TIME_STAMP_2_ADDR A:0x7c5c070
y.create.l HWIO_EMAC_0_EMAC_P1588_RX_TIME_STAMP_1_ADDR A:0x7c5c074
y.create.l HWIO_EMAC_0_EMAC_P1588_RX_TIME_STAMP_6_ADDR A:0x7c5c078
y.create.l HWIO_EMAC_0_EMAC_P1588_RX_FRAC_NANO_ADDR A:0x7c5c07c
y.create.l HWIO_EMAC_0_EMAC_P1588_TX_SEQUENCE_ID_ADDR A:0x7c5c080
y.create.l HWIO_EMAC_0_EMAC_P1588_TX_SRC_PORT_ID_5_ADDR A:0x7c5c084
y.create.l HWIO_EMAC_0_EMAC_P1588_TX_SRC_PORT_ID_4_ADDR A:0x7c5c088
y.create.l HWIO_EMAC_0_EMAC_P1588_TX_SRC_PORT_ID_3_ADDR A:0x7c5c08c
y.create.l HWIO_EMAC_0_EMAC_P1588_TX_SRC_PORT_ID_2_ADDR A:0x7c5c090
y.create.l HWIO_EMAC_0_EMAC_P1588_TX_SRC_PORT_ID_1_ADDR A:0x7c5c094
y.create.l HWIO_EMAC_0_EMAC_P1588_TX_TIME_STAMP_5_ADDR A:0x7c5c098
y.create.l HWIO_EMAC_0_EMAC_P1588_TX_TIME_STAMP_4_ADDR A:0x7c5c09c
y.create.l HWIO_EMAC_0_EMAC_P1588_TX_TIME_STAMP_3_ADDR A:0x7c5c0a0
y.create.l HWIO_EMAC_0_EMAC_P1588_TX_TIME_STAMP_2_ADDR A:0x7c5c0a4
y.create.l HWIO_EMAC_0_EMAC_P1588_TX_TIME_STAMP_1_ADDR A:0x7c5c0a8
y.create.l HWIO_EMAC_0_EMAC_P1588_TX_TIME_STAMP_6_ADDR A:0x7c5c0ac
y.create.l HWIO_EMAC_0_EMAC_P1588_TX_FRAC_NANO_ADDR A:0x7c5c0b0
y.create.l HWIO_EMAC_0_EMAC_P1588_TX_ORIGIN_CORRECTION_4_ADDR A:0x7c5c0b4
y.create.l HWIO_EMAC_0_EMAC_P1588_TX_ORIGIN_CORRECTION_3_ADDR A:0x7c5c0b8
y.create.l HWIO_EMAC_0_EMAC_P1588_TX_ORIGIN_CORRECTION_2_ADDR A:0x7c5c0bc
y.create.l HWIO_EMAC_0_EMAC_P1588_TX_ORIGIN_CORRECTION_1_ADDR A:0x7c5c0c0
y.create.l HWIO_EMAC_0_EMAC_P1588_TX_INGRESS_TRIG_TIME_4_ADDR A:0x7c5c0c4
y.create.l HWIO_EMAC_0_EMAC_P1588_TX_INGRESS_TRIG_TIME_3_ADDR A:0x7c5c0c8
y.create.l HWIO_EMAC_0_EMAC_P1588_TX_INGRESS_TRIG_TIME_2_ADDR A:0x7c5c0cc
y.create.l HWIO_EMAC_0_EMAC_P1588_TX_INGRESS_TRIG_TIME_1_ADDR A:0x7c5c0d0
y.create.l HWIO_EMAC_0_EMAC_P1588_TX_LATENCY_ADDR A:0x7c5c0d4
y.create.l HWIO_EMAC_0_EMAC_P1588_INC_VALUE_2_ADDR A:0x7c5c0d8
y.create.l HWIO_EMAC_0_EMAC_P1588_INC_VALUE_1_ADDR A:0x7c5c0dc
y.create.l HWIO_EMAC_0_EMAC_P1588_NANO_OFFSET_2_ADDR A:0x7c5c0e0
y.create.l HWIO_EMAC_0_EMAC_P1588_NANO_OFFSET_1_ADDR A:0x7c5c0e4
y.create.l HWIO_EMAC_0_EMAC_P1588_SEC_OFFSET_3_ADDR A:0x7c5c0e8
y.create.l HWIO_EMAC_0_EMAC_P1588_SEC_OFFSET_2_ADDR A:0x7c5c0ec
y.create.l HWIO_EMAC_0_EMAC_P1588_SEC_OFFSET_1_ADDR A:0x7c5c0f0
y.create.l HWIO_EMAC_0_EMAC_P1588_REAL_TIME_5_ADDR A:0x7c5c0f4
y.create.l HWIO_EMAC_0_EMAC_P1588_REAL_TIME_4_ADDR A:0x7c5c0f8
y.create.l HWIO_EMAC_0_EMAC_P1588_REAL_TIME_3_ADDR A:0x7c5c0fc
y.create.l HWIO_EMAC_0_EMAC_P1588_REAL_TIME_2_ADDR A:0x7c5c100
y.create.l HWIO_EMAC_0_EMAC_P1588_REAL_TIME_1_ADDR A:0x7c5c104
y.create.l HWIO_EMAC_0_EMAC_P1588_RFC_FRAC_NANO_2_ADDR A:0x7c5c108
y.create.l HWIO_EMAC_0_EMAC_P1588_RFC_FRAC_NANO_1_ADDR A:0x7c5c10c
y.create.l HWIO_EMAC_0_EMAC_P1588_ADJUST_RTC_ADDR A:0x7c5c110
y.create.l HWIO_EMAC_0_EMAC_P1588_MISC_CONFIG_ADDR A:0x7c5c3c0
y.create.l HWIO_EMAC_0_EMAC_P1588_PTP_EXPANDED_INT_MASK_ADDR A:0x7c5c3c4
y.create.l HWIO_EMAC_0_EMAC_P1588_PTP_EXPANDED_INT_STATUS_ADDR A:0x7c5c3c8
y.create.l HWIO_EMAC_0_EMAC_P1588_LINK_DELAY_2_ADDR A:0x7c5c3cc
y.create.l HWIO_EMAC_0_EMAC_P1588_LINK_DELAY_1_ADDR A:0x7c5c3d0
y.create.l HWIO_EMAC_0_EMAC_P1588_RTC_EXPANDED_CONFIG_ADDR A:0x7c5c400
y.create.l HWIO_EMAC_0_EMAC_P1588_RTC_PRELOADED_5_ADDR A:0x7c5c404
y.create.l HWIO_EMAC_0_EMAC_P1588_RTC_PRELOADED_4_ADDR A:0x7c5c408
y.create.l HWIO_EMAC_0_EMAC_P1588_RTC_PRELOADED_3_ADDR A:0x7c5c40c
y.create.l HWIO_EMAC_0_EMAC_P1588_RTC_PRELOADED_2_ADDR A:0x7c5c410
y.create.l HWIO_EMAC_0_EMAC_P1588_RTC_PRELOADED_1_ADDR A:0x7c5c414
y.create.l HWIO_EMAC_0_EMAC_P1588_GRAND_MASTER_CONFIG_0_ADDR A:0x7c5c800
y.create.l HWIO_EMAC_0_EMAC_P1588_GRAND_MASTER_CONFIG_1_ADDR A:0x7c5c804
y.create.l HWIO_EMAC_0_EMAC_P1588_GM_PPS_TIMESTAMP_5_ADDR A:0x7c5c808
y.create.l HWIO_EMAC_0_EMAC_P1588_GM_PPS_TIMESTAMP_4_ADDR A:0x7c5c80c
y.create.l HWIO_EMAC_0_EMAC_P1588_GM_PPS_TIMESTAMP_3_ADDR A:0x7c5c810
y.create.l HWIO_EMAC_0_EMAC_P1588_GM_PPS_TIMESTAMP_2_ADDR A:0x7c5c814
y.create.l HWIO_EMAC_0_EMAC_P1588_GM_PPS_TIMESTAMP_1_ADDR A:0x7c5c818
y.create.l HWIO_EMAC_0_EMAC_P1588_CURRENT_INC_VALUE_2_ADDR A:0x7c5c81c
y.create.l HWIO_EMAC_0_EMAC_P1588_CURRENT_INC_VALUE_1_ADDR A:0x7c5c820
y.create.l HWIO_EMAC_0_EMAC_P1588_PPSIN_LATENCY_ADDR A:0x7c5c824
y.create.l HWIO_EMAC_0_EMAC_P1588_PHASE_ADJUST_2_ADDR A:0x7c5cc00
y.create.l HWIO_EMAC_0_EMAC_P1588_PHASE_ADJUST_1_ADDR A:0x7c5cc04
y.create.l HWIO_EMAC_0_EMAC_P1588_PPS_PUL_WIDTH_HIGH_ADDR A:0x7c5cc0c
y.create.l HWIO_EMAC_0_EMAC_P1588_PPS_PUL_WIDTH_LOW_ADDR A:0x7c5cc10
y.create.l HWIO_EMAC_0_EMAC_P1588_WAVE_PERIOD_3_ADDR A:0x7c5cc14
y.create.l HWIO_EMAC_0_EMAC_P1588_WAVE_PERIOD_2_ADDR A:0x7c5cc18
y.create.l HWIO_EMAC_0_EMAC_P1588_WAVE_PERIOD_1_ADDR A:0x7c5cc1c
y.create.l HWIO_EMAC_0_EMAC_P1588_TRIG0_CONFIG_ADDR A:0x7c5d000
y.create.l HWIO_EMAC_0_EMAC_P1588_TRIG0_STATUS_ADDR A:0x7c5d004
y.create.l HWIO_EMAC_0_EMAC_P1588_TRIG1_CONFIG_ADDR A:0x7c5d008
y.create.l HWIO_EMAC_0_EMAC_P1588_TRIG1_STATUS_ADDR A:0x7c5d00c
y.create.l HWIO_EMAC_0_EMAC_P1588_TRIG0_TIME_5_ADDR A:0x7c5d010
y.create.l HWIO_EMAC_0_EMAC_P1588_TRIG0_TIME_4_ADDR A:0x7c5d014
y.create.l HWIO_EMAC_0_EMAC_P1588_TRIG0_TIME_3_ADDR A:0x7c5d018
y.create.l HWIO_EMAC_0_EMAC_P1588_TRIG0_TIME_2_ADDR A:0x7c5d01c
y.create.l HWIO_EMAC_0_EMAC_P1588_TRIG0_TIME_1_ADDR A:0x7c5d020
y.create.l HWIO_EMAC_0_EMAC_P1588_TRIG1_TIME_5_ADDR A:0x7c5d024
y.create.l HWIO_EMAC_0_EMAC_P1588_TRIG1_TIME_4_ADDR A:0x7c5d028
y.create.l HWIO_EMAC_0_EMAC_P1588_TRIG1_TIME_3_ADDR A:0x7c5d02c
y.create.l HWIO_EMAC_0_EMAC_P1588_TRIG1_TIME_2_ADDR A:0x7c5d030
y.create.l HWIO_EMAC_0_EMAC_P1588_TRIG1_TIME_1_ADDR A:0x7c5d034
y.create.l HWIO_EMAC_0_EMAC_P1588_EVENT0_CONFIG_ADDR A:0x7c5d038
y.create.l HWIO_EMAC_0_EMAC_P1588_EVENT0_STATUS_ADDR A:0x7c5d03c
y.create.l HWIO_EMAC_0_EMAC_P1588_EVENT1_CONFIG_ADDR A:0x7c5d040
y.create.l HWIO_EMAC_0_EMAC_P1588_EVENT1_STATUS_ADDR A:0x7c5d044
y.create.l HWIO_EMAC_0_EMAC_P1588_EVENT0_TIMESTAMP_5_ADDR A:0x7c5d048
y.create.l HWIO_EMAC_0_EMAC_P1588_EVENT0_TIMESTAMP_4_ADDR A:0x7c5d04c
y.create.l HWIO_EMAC_0_EMAC_P1588_EVENT0_TIMESTAMP_3_ADDR A:0x7c5d050
y.create.l HWIO_EMAC_0_EMAC_P1588_EVENT0_TIMESTAMP_2_ADDR A:0x7c5d054
y.create.l HWIO_EMAC_0_EMAC_P1588_EVENT0_TIMESTAMP_1_ADDR A:0x7c5d058
y.create.l HWIO_EMAC_0_EMAC_P1588_EVENT1_TIMESTAMP_5_ADDR A:0x7c5d05c
y.create.l HWIO_EMAC_0_EMAC_P1588_EVENT1_TIMESTAMP_4_ADDR A:0x7c5d060
y.create.l HWIO_EMAC_0_EMAC_P1588_EVENT1_TIMESTAMP_3_ADDR A:0x7c5d064
y.create.l HWIO_EMAC_0_EMAC_P1588_EVENT1_TIMESTAMP_2_ADDR A:0x7c5d068
y.create.l HWIO_EMAC_0_EMAC_P1588_EVENT1_TIMESTAMP_1_ADDR A:0x7c5d06c
y.create.l HWIO_EMAC_0_EMAC_P1588_RX_SEQUENCE_ID_PRE_ADDR A:0x7c5d400
y.create.l HWIO_EMAC_0_EMAC_P1588_RX_SRC_PORT_ID_PRE_5_ADDR A:0x7c5d404
y.create.l HWIO_EMAC_0_EMAC_P1588_RX_SRC_PORT_ID_PRE_4_ADDR A:0x7c5d408
y.create.l HWIO_EMAC_0_EMAC_P1588_RX_SRC_PORT_ID_PRE_3_ADDR A:0x7c5d40c
y.create.l HWIO_EMAC_0_EMAC_P1588_RX_SRC_PORT_ID_PRE_2_ADDR A:0x7c5d410
y.create.l HWIO_EMAC_0_EMAC_P1588_RX_SRC_PORT_ID_PRE_1_ADDR A:0x7c5d414
y.create.l HWIO_EMAC_0_EMAC_P1588_RX_TIMESTAMP_PRE_5_ADDR A:0x7c5d418
y.create.l HWIO_EMAC_0_EMAC_P1588_RX_TIMESTAMP_PRE_4_ADDR A:0x7c5d41c
y.create.l HWIO_EMAC_0_EMAC_P1588_RX_TIMESTAMP_PRE_3_ADDR A:0x7c5d420
y.create.l HWIO_EMAC_0_EMAC_P1588_RX_TIMESTAMP_PRE_2_ADDR A:0x7c5d424
y.create.l HWIO_EMAC_0_EMAC_P1588_RX_TIMESTAMP_PRE_1_ADDR A:0x7c5d428
y.create.l HWIO_EMAC_0_EMAC_P1588_RX_TIMESTAMP_PRE_6_ADDR A:0x7c5d42c
y.create.l HWIO_EMAC_0_EMAC_P1588_RX_FRAC_NANO_PRE_1_ADDR A:0x7c5d430
y.create.l HWIO_EMAC_0_EMAC_P1588_RX_SEQUENCE_ID_PRE2_ADDR A:0x7c5d468
y.create.l HWIO_EMAC_0_EMAC_P1588_RX_SRC_PORT_ID_PRE2_5_ADDR A:0x7c5d46c
y.create.l HWIO_EMAC_0_EMAC_P1588_RX_SRC_PORT_ID_PRE2_4_ADDR A:0x7c5d470
y.create.l HWIO_EMAC_0_EMAC_P1588_RX_SRC_PORT_ID_PRE2_3_ADDR A:0x7c5d474
y.create.l HWIO_EMAC_0_EMAC_P1588_RX_SRC_PORT_ID_PRE2_2_ADDR A:0x7c5d478
y.create.l HWIO_EMAC_0_EMAC_P1588_RX_SRC_PORT_ID_PRE2_1_ADDR A:0x7c5d47c
y.create.l HWIO_EMAC_0_EMAC_P1588_RX_TIMESTAMP_PRE2_5_ADDR A:0x7c5d480
y.create.l HWIO_EMAC_0_EMAC_P1588_RX_TIMESTAMP_PRE2_4_ADDR A:0x7c5d484
y.create.l HWIO_EMAC_0_EMAC_P1588_RX_TIMESTAMP_PRE2_3_ADDR A:0x7c5d488
y.create.l HWIO_EMAC_0_EMAC_P1588_RX_TIMESTAMP_PRE2_2_ADDR A:0x7c5d48c
y.create.l HWIO_EMAC_0_EMAC_P1588_RX_TIMESTAMP_PRE2_1_ADDR A:0x7c5d490
y.create.l HWIO_EMAC_0_EMAC_P1588_RX_TIMESTAMP_PRE2_6_ADDR A:0x7c5d494
y.create.l HWIO_EMAC_0_EMAC_P1588_RX_FRAC_NANO_PRE2_1_ADDR A:0x7c5d498
y.create.l HWIO_EMAC_0_EMAC_P1588_RX_SEQUENCE_ID_PRE3_ADDR A:0x7c5d4d0
y.create.l HWIO_EMAC_0_EMAC_P1588_RX_SRC_PORT_ID_PRE3_5_ADDR A:0x7c5d4d4
y.create.l HWIO_EMAC_0_EMAC_P1588_RX_SRC_PORT_ID_PRE3_4_ADDR A:0x7c5d4d8
y.create.l HWIO_EMAC_0_EMAC_P1588_RX_SRC_PORT_ID_PRE3_3_ADDR A:0x7c5d4dc
y.create.l HWIO_EMAC_0_EMAC_P1588_RX_SRC_PORT_ID_PRE3_2_ADDR A:0x7c5d4e0
y.create.l HWIO_EMAC_0_EMAC_P1588_RX_SRC_PORT_ID_PRE3_1_ADDR A:0x7c5d4e4
y.create.l HWIO_EMAC_0_EMAC_P1588_RX_TIMESTAMP_PRE3_5_ADDR A:0x7c5d4e8
y.create.l HWIO_EMAC_0_EMAC_P1588_RX_TIMESTAMP_PRE3_4_ADDR A:0x7c5d4ec
y.create.l HWIO_EMAC_0_EMAC_P1588_RX_TIMESTAMP_PRE3_3_ADDR A:0x7c5d4f0
y.create.l HWIO_EMAC_0_EMAC_P1588_RX_TIMESTAMP_PRE3_2_ADDR A:0x7c5d4f4
y.create.l HWIO_EMAC_0_EMAC_P1588_RX_TIMESTAMP_PRE3_1_ADDR A:0x7c5d4f8
y.create.l HWIO_EMAC_0_EMAC_P1588_RX_TIMESTAMP_PRE3_6_ADDR A:0x7c5d4fc
y.create.l HWIO_EMAC_0_EMAC_P1588_RX_FRAC_NANO_PRE3_1_ADDR A:0x7c5d500
y.create.l HWIO_EMAC_0_EMAC_P1588_RX_COM_TS_CTRL_ADDR A:0x7c5d800
y.create.l HWIO_EMAC_0_EMAC_P1588_RX_FILT_MAC_DA_3_ADDR A:0x7c5d804
y.create.l HWIO_EMAC_0_EMAC_P1588_RX_FILT_MAC_DA_2_ADDR A:0x7c5d808
y.create.l HWIO_EMAC_0_EMAC_P1588_RX_FILT_MAC_DA_1_ADDR A:0x7c5d80c
y.create.l HWIO_EMAC_0_EMAC_P1588_RX_FILT_IPV4_DA_2_ADDR A:0x7c5d810
y.create.l HWIO_EMAC_0_EMAC_P1588_RX_FILT_IPV4_DA_1_ADDR A:0x7c5d814
y.create.l HWIO_EMAC_0_EMAC_P1588_RX_FILT_IPV6_DA_8_ADDR A:0x7c5d818
y.create.l HWIO_EMAC_0_EMAC_P1588_RX_FILT_IPV6_DA_7_ADDR A:0x7c5d81c
y.create.l HWIO_EMAC_0_EMAC_P1588_RX_FILT_IPV6_DA_6_ADDR A:0x7c5d820
y.create.l HWIO_EMAC_0_EMAC_P1588_RX_FILT_IPV6_DA_5_ADDR A:0x7c5d824
y.create.l HWIO_EMAC_0_EMAC_P1588_RX_FILT_IPV6_DA_4_ADDR A:0x7c5d828
y.create.l HWIO_EMAC_0_EMAC_P1588_RX_FILT_IPV6_DA_3_ADDR A:0x7c5d82c
y.create.l HWIO_EMAC_0_EMAC_P1588_RX_FILT_IPV6_DA_2_ADDR A:0x7c5d830
y.create.l HWIO_EMAC_0_EMAC_P1588_RX_FILT_IPV6_DA_1_ADDR A:0x7c5d834
y.create.l HWIO_EMAC_0_EMAC_P1588_RX_FILT_MAC_LENGTHTYPE_ADDR A:0x7c5d838
y.create.l HWIO_EMAC_0_EMAC_P1588_RX_FILT_LAYER4_PROTOCOL_ADDR A:0x7c5d83c
y.create.l HWIO_EMAC_0_EMAC_P1588_RX_FILT_UDP_PORT_ADDR A:0x7c5d840
y.create.l HWIO_EMAC_0_EMAC_P1588_RX_COM_TS_STATUS_ADDR A:0x7c5d844
y.create.l HWIO_EMAC_0_EMAC_P1588_RX_COM_TIMESTAMP_5_ADDR A:0x7c5d848
y.create.l HWIO_EMAC_0_EMAC_P1588_RX_COM_TIMESTAMP_4_ADDR A:0x7c5d84c
y.create.l HWIO_EMAC_0_EMAC_P1588_RX_COM_TIMESTAMP_3_ADDR A:0x7c5d850
y.create.l HWIO_EMAC_0_EMAC_P1588_RX_COM_TIMESTAMP_2_ADDR A:0x7c5d854
y.create.l HWIO_EMAC_0_EMAC_P1588_RX_COM_TIMESTAMP_1_ADDR A:0x7c5d858
y.create.l HWIO_EMAC_0_EMAC_P1588_RX_COM_FRAC_NANO_ADDR A:0x7c5d85c
y.create.l HWIO_EMAC_0_EMAC_P1588_RX_COM_TIMESTAMP_PRE_5_ADDR A:0x7c5d860
y.create.l HWIO_EMAC_0_EMAC_P1588_RX_COM_TIMESTAMP_PRE_4_ADDR A:0x7c5d864
y.create.l HWIO_EMAC_0_EMAC_P1588_RX_COM_TIMESTAMP_PRE_3_ADDR A:0x7c5d868
y.create.l HWIO_EMAC_0_EMAC_P1588_RX_COM_TIMESTAMP_PRE_2_ADDR A:0x7c5d86c
y.create.l HWIO_EMAC_0_EMAC_P1588_RX_COM_TIMESTAMP_PRE_1_ADDR A:0x7c5d870
y.create.l HWIO_EMAC_0_EMAC_P1588_RX_COM_FRAC_NANO_PRE_ADDR A:0x7c5d874
y.create.l HWIO_EMAC_0_EMAC_P1588_RX_Y1731_IDENTITY_ADDR A:0x7c5d878
y.create.l HWIO_EMAC_0_EMAC_P1588_RX_Y1731_IDENTITY_PRE_ADDR A:0x7c5d87c
y.create.l HWIO_EMAC_0_EMAC_P1588_TX_COM_TS_CTRL_ADDR A:0x7c5d880
y.create.l HWIO_EMAC_0_EMAC_P1588_TX_FILT_MAC_DA_3_ADDR A:0x7c5d884
y.create.l HWIO_EMAC_0_EMAC_P1588_TX_FILT_MAC_DA_2_ADDR A:0x7c5d888
y.create.l HWIO_EMAC_0_EMAC_P1588_TX_FILT_MAC_DA_1_ADDR A:0x7c5d88c
y.create.l HWIO_EMAC_0_EMAC_P1588_TX_FILT_IPV4_DA_2_ADDR A:0x7c5d890
y.create.l HWIO_EMAC_0_EMAC_P1588_TX_FILT_IPV4_DA_1_ADDR A:0x7c5d894
y.create.l HWIO_EMAC_0_EMAC_P1588_TX_FILT_IPV6_DA_8_ADDR A:0x7c5d898
y.create.l HWIO_EMAC_0_EMAC_P1588_TX_FILT_IPV6_DA_7_ADDR A:0x7c5d89c
y.create.l HWIO_EMAC_0_EMAC_P1588_TX_FILT_IPV6_DA_6_ADDR A:0x7c5d8a0
y.create.l HWIO_EMAC_0_EMAC_P1588_TX_FILT_IPV6_DA_5_ADDR A:0x7c5d8a4
y.create.l HWIO_EMAC_0_EMAC_P1588_TX_FILT_IPV6_DA_4_ADDR A:0x7c5d8a8
y.create.l HWIO_EMAC_0_EMAC_P1588_TX_FILT_IPV6_DA_3_ADDR A:0x7c5d8ac
y.create.l HWIO_EMAC_0_EMAC_P1588_TX_FILT_IPV6_DA_2_ADDR A:0x7c5d8b0
y.create.l HWIO_EMAC_0_EMAC_P1588_TX_FILT_IPV6_DA_1_ADDR A:0x7c5d8b4
y.create.l HWIO_EMAC_0_EMAC_P1588_TX_FILT_MAC_LENGTHTYPE_ADDR A:0x7c5d8b8
y.create.l HWIO_EMAC_0_EMAC_P1588_TX_FILT_LAYER4_PROTOCOL_ADDR A:0x7c5d8bc
y.create.l HWIO_EMAC_0_EMAC_P1588_TX_FILT_UDP_PORT_ADDR A:0x7c5d8c0
y.create.l HWIO_EMAC_0_EMAC_P1588_TX_COM_TS_STATUS_ADDR A:0x7c5d8c4
y.create.l HWIO_EMAC_0_EMAC_P1588_TX_COM_TIMESTAMP_5_ADDR A:0x7c5d8c8
y.create.l HWIO_EMAC_0_EMAC_P1588_TX_COM_TIMESTAMP_4_ADDR A:0x7c5d8cc
y.create.l HWIO_EMAC_0_EMAC_P1588_TX_COM_TIMESTAMP_3_ADDR A:0x7c5d8d0
y.create.l HWIO_EMAC_0_EMAC_P1588_TX_COM_TIMESTAMP_2_ADDR A:0x7c5d8d4
y.create.l HWIO_EMAC_0_EMAC_P1588_TX_COM_TIMESTAMP_1_ADDR A:0x7c5d8d8
y.create.l HWIO_EMAC_0_EMAC_P1588_TX_COM_FRAC_NANO_ADDR A:0x7c5d8dc
y.create.l HWIO_EMAC_0_EMAC_P1588_TX_Y1731_IDENTITY_ADDR A:0x7c5d8f8
y.create.l HWIO_EMAC_0_EMAC_P1588_Y1731_DM_CONTROL_ADDR A:0x7c5d900
y.create.l HWIO_EMAC_0_EMAC_P1588_LOC_MAC_ADDR_O_3_ADDR A:0x7c5c128
y.create.l HWIO_EMAC_0_EMAC_P1588_LOC_MAC_ADDR_O_2_ADDR A:0x7c5c12c
y.create.l HWIO_EMAC_0_EMAC_P1588_LOC_MAC_ADDR_O_1_ADDR A:0x7c5c130
y.create.l HWIO_EMAC_0_EMAC_P1588_BAUD_CONFIG_ADDR A:0x7c5dc00
y.create.l HWIO_EMAC_0_EMAC_P1588_UART_CONFIGURATION_ADDR A:0x7c5dc04
y.create.l HWIO_EMAC_0_EMAC_P1588_RESET_UART_BUFFER_ADDR A:0x7c5dc08
y.create.l HWIO_EMAC_0_EMAC_P1588_UART_BUFFER_RX_TX_STATUS_ADDR A:0x7c5dc0c
y.create.l HWIO_EMAC_0_EMAC_P1588_TX_BUFFER_WRITE_ADDR A:0x7c5dc10
y.create.l HWIO_EMAC_0_EMAC_P1588_RX_BUFFER_READ_ADDR A:0x7c5dc14
y.create.l HWIO_EMAC_0_EMAC_XPU_SCR_ADDR A:0x7c50000
y.create.l HWIO_EMAC_0_EMAC_XPU_SWDR_ADDR A:0x7c50004
y.create.l HWIO_EMAC_0_EMAC_XPU_SEAR0_ADDR A:0x7c50040
y.create.l HWIO_EMAC_0_EMAC_XPU_SESR_ADDR A:0x7c50048
y.create.l HWIO_EMAC_0_EMAC_XPU_SESRRESTORE_ADDR A:0x7c5004c
y.create.l HWIO_EMAC_0_EMAC_XPU_SESYNR0_ADDR A:0x7c50050
y.create.l HWIO_EMAC_0_EMAC_XPU_SESYNR1_ADDR A:0x7c50054
y.create.l HWIO_EMAC_0_EMAC_XPU_SESYNR2_ADDR A:0x7c50058
y.create.l HWIO_EMAC_0_EMAC_XPU_MCR_ADDR A:0x7c50100
y.create.l HWIO_EMAC_0_EMAC_XPU_MEAR0_ADDR A:0x7c50140
y.create.l HWIO_EMAC_0_EMAC_XPU_MESR_ADDR A:0x7c50148
y.create.l HWIO_EMAC_0_EMAC_XPU_MESRRESTORE_ADDR A:0x7c5014c
y.create.l HWIO_EMAC_0_EMAC_XPU_MESYNR0_ADDR A:0x7c50150
y.create.l HWIO_EMAC_0_EMAC_XPU_MESYNR1_ADDR A:0x7c50154
y.create.l HWIO_EMAC_0_EMAC_XPU_MESYNR2_ADDR A:0x7c50158
y.create.l HWIO_EMAC_0_EMAC_XPU_CR_ADDR A:0x7c50080
y.create.l HWIO_EMAC_0_EMAC_XPU_RPU_ACR0_ADDR A:0x7c500a0
y.create.l HWIO_EMAC_0_EMAC_XPU_EAR0_ADDR A:0x7c500c0
y.create.l HWIO_EMAC_0_EMAC_XPU_ESR_ADDR A:0x7c500c8
y.create.l HWIO_EMAC_0_EMAC_XPU_ESRRESTORE_ADDR A:0x7c500cc
y.create.l HWIO_EMAC_0_EMAC_XPU_ESYNR0_ADDR A:0x7c500d0
y.create.l HWIO_EMAC_0_EMAC_XPU_ESYNR1_ADDR A:0x7c500d4
y.create.l HWIO_EMAC_0_EMAC_XPU_ESYNR2_ADDR A:0x7c500d8
y.create.l HWIO_EMAC_0_EMAC_XPU_IDR0_ADDR A:0x7c50074
y.create.l HWIO_EMAC_0_EMAC_XPU_IDR1_ADDR A:0x7c50078
y.create.l HWIO_EMAC_0_EMAC_XPU_REV_ADDR A:0x7c5007c
y.create.l HWIO_EMAC_0_EMAC_XPU_RG0_RACR0_ADDR A:0x7c50200
y.create.l HWIO_EMAC_0_EMAC_XPU_RG0_SCR_ADDR A:0x7c50250
y.create.l HWIO_EMAC_0_EMAC_XPU_RG0_MCR_ADDR A:0x7c50254
y.create.l HWIO_EMAC_0_EMAC_VMIDMT_SCR0_ADDR A:0x7c54000
y.create.l HWIO_EMAC_0_EMAC_VMIDMT_SCR1_ADDR A:0x7c54004
y.create.l HWIO_EMAC_0_EMAC_VMIDMT_SCR2_ADDR A:0x7c54008
y.create.l HWIO_EMAC_0_EMAC_VMIDMT_SACR_ADDR A:0x7c54010
y.create.l HWIO_EMAC_0_EMAC_VMIDMT_SIDR0_ADDR A:0x7c54020
y.create.l HWIO_EMAC_0_EMAC_VMIDMT_SIDR1_ADDR A:0x7c54024
y.create.l HWIO_EMAC_0_EMAC_VMIDMT_SIDR2_ADDR A:0x7c54028
y.create.l HWIO_EMAC_0_EMAC_VMIDMT_SIDR4_ADDR A:0x7c54030
y.create.l HWIO_EMAC_0_EMAC_VMIDMT_SIDR5_ADDR A:0x7c54034
y.create.l HWIO_EMAC_0_EMAC_VMIDMT_SIDR7_ADDR A:0x7c5403c
y.create.l HWIO_EMAC_0_EMAC_VMIDMT_SGFAR0_ADDR A:0x7c54040
y.create.l HWIO_EMAC_0_EMAC_VMIDMT_SGFSR_ADDR A:0x7c54048
y.create.l HWIO_EMAC_0_EMAC_VMIDMT_SGFSRRESTORE_ADDR A:0x7c5404c
y.create.l HWIO_EMAC_0_EMAC_VMIDMT_SGFSYNDR0_ADDR A:0x7c54050
y.create.l HWIO_EMAC_0_EMAC_VMIDMT_SGFSYNDR1_ADDR A:0x7c54054
y.create.l HWIO_EMAC_0_EMAC_VMIDMT_SGFSYNDR2_ADDR A:0x7c54058
y.create.l HWIO_EMAC_0_EMAC_VMIDMT_VMIDMTSCR0_ADDR A:0x7c54090
y.create.l HWIO_EMAC_0_EMAC_VMIDMT_CR0_ADDR A:0x7c54000
y.create.l HWIO_EMAC_0_EMAC_VMIDMT_CR2_ADDR A:0x7c54008
y.create.l HWIO_EMAC_0_EMAC_VMIDMT_ACR_ADDR A:0x7c54010
y.create.l HWIO_EMAC_0_EMAC_VMIDMT_IDR0_ADDR A:0x7c54020
y.create.l HWIO_EMAC_0_EMAC_VMIDMT_IDR1_ADDR A:0x7c54024
y.create.l HWIO_EMAC_0_EMAC_VMIDMT_IDR2_ADDR A:0x7c54028
y.create.l HWIO_EMAC_0_EMAC_VMIDMT_IDR4_ADDR A:0x7c54030
y.create.l HWIO_EMAC_0_EMAC_VMIDMT_IDR5_ADDR A:0x7c54034
y.create.l HWIO_EMAC_0_EMAC_VMIDMT_IDR7_ADDR A:0x7c5403c
y.create.l HWIO_EMAC_0_EMAC_VMIDMT_GFAR0_ADDR A:0x7c54040
y.create.l HWIO_EMAC_0_EMAC_VMIDMT_GFSR_ADDR A:0x7c54048
y.create.l HWIO_EMAC_0_EMAC_VMIDMT_GFSRRESTORE_ADDR A:0x7c5404c
y.create.l HWIO_EMAC_0_EMAC_VMIDMT_GFSYNDR0_ADDR A:0x7c54050
y.create.l HWIO_EMAC_0_EMAC_VMIDMT_GFSYNDR1_ADDR A:0x7c54054
y.create.l HWIO_EMAC_0_EMAC_VMIDMT_GFSYNDR2_ADDR A:0x7c54058
y.create.l HWIO_EMAC_0_EMAC_VMIDMT_VMIDMTCR0_ADDR A:0x7c54090
y.create.l HWIO_EMAC_0_EMAC_VMIDMT_VMIDMTACR_ADDR A:0x7c5409c
y.create.l HWIO_EMAC_0_EMAC_VMIDMT_NSCR0_ADDR A:0x7c54400
y.create.l HWIO_EMAC_0_EMAC_VMIDMT_NSCR2_ADDR A:0x7c54408
y.create.l HWIO_EMAC_0_EMAC_VMIDMT_NSACR_ADDR A:0x7c54410
y.create.l HWIO_EMAC_0_EMAC_VMIDMT_NSGFAR0_ADDR A:0x7c54440
y.create.l HWIO_EMAC_0_EMAC_VMIDMT_NSGFSR_ADDR A:0x7c54448
y.create.l HWIO_EMAC_0_EMAC_VMIDMT_NSGFSRRESTORE_ADDR A:0x7c5444c
y.create.l HWIO_EMAC_0_EMAC_VMIDMT_NSGFSYNDR0_ADDR A:0x7c54450
y.create.l HWIO_EMAC_0_EMAC_VMIDMT_NSGFSYNDR1_ADDR A:0x7c54454
y.create.l HWIO_EMAC_0_EMAC_VMIDMT_NSGFSYNDR2_ADDR A:0x7c54458
y.create.l HWIO_EMAC_0_EMAC_VMIDMT_NSVMIDMTCR0_ADDR A:0x7c54490
y.create.l HWIO_EMAC_0_EMAC_VMIDMT_SSDR0_ADDR A:0x7c54080
y.create.l HWIO_EMAC_0_EMAC_VMIDMT_MSDR0_ADDR A:0x7c54480
y.create.l HWIO_EMAC_0_EMAC_VMIDMT_MCR_ADDR A:0x7c54494
y.create.l HWIO_EMAC_0_EMAC_VMIDMT_S2VR0_ADDR A:0x7c54c00
y.create.l HWIO_EMAC_0_EMAC_VMIDMT_AS2VR0_ADDR A:0x7c54e00
y.create.l HWIO_EMAC_0_EMAC_QSERDES_COM_SYS_CLK_CTRL_ADDR A:0x7c58000
y.create.l HWIO_EMAC_0_EMAC_QSERDES_COM_PLL_VCOTAIL_EN_ADDR A:0x7c58004
y.create.l HWIO_EMAC_0_EMAC_QSERDES_COM_CMN_MODE_ADDR A:0x7c58008
y.create.l HWIO_EMAC_0_EMAC_QSERDES_COM_IE_TRIM_ADDR A:0x7c5800c
y.create.l HWIO_EMAC_0_EMAC_QSERDES_COM_IP_TRIM_ADDR A:0x7c58010
y.create.l HWIO_EMAC_0_EMAC_QSERDES_COM_PLL_CNTRL_ADDR A:0x7c58014
y.create.l HWIO_EMAC_0_EMAC_QSERDES_COM_PLL_IP_SETI_ADDR A:0x7c58018
y.create.l HWIO_EMAC_0_EMAC_QSERDES_COM_CORE_CLK_IN_SYNC_SEL_ADDR A:0x7c5801c
y.create.l HWIO_EMAC_0_EMAC_QSERDES_COM_BIAS_EN_CLKBUFLR_EN_ADDR A:0x7c58020
y.create.l HWIO_EMAC_0_EMAC_QSERDES_COM_PLL_CP_SETI_ADDR A:0x7c58024
y.create.l HWIO_EMAC_0_EMAC_QSERDES_COM_PLL_IP_SETP_ADDR A:0x7c58028
y.create.l HWIO_EMAC_0_EMAC_QSERDES_COM_PLL_CP_SETP_ADDR A:0x7c5802c
y.create.l HWIO_EMAC_0_EMAC_QSERDES_COM_ATB_SEL1_ADDR A:0x7c58030
y.create.l HWIO_EMAC_0_EMAC_QSERDES_COM_ATB_SEL2_ADDR A:0x7c58034
y.create.l HWIO_EMAC_0_EMAC_QSERDES_COM_SYSCLK_EN_SEL_ADDR A:0x7c58038
y.create.l HWIO_EMAC_0_EMAC_QSERDES_COM_RES_CODE_TXBAND_ADDR A:0x7c5803c
y.create.l HWIO_EMAC_0_EMAC_QSERDES_COM_RESETSM_CNTRL_ADDR A:0x7c58040
y.create.l HWIO_EMAC_0_EMAC_QSERDES_COM_PLLLOCK_CMP1_ADDR A:0x7c58044
y.create.l HWIO_EMAC_0_EMAC_QSERDES_COM_PLLLOCK_CMP2_ADDR A:0x7c58048
y.create.l HWIO_EMAC_0_EMAC_QSERDES_COM_PLLLOCK_CMP3_ADDR A:0x7c5804c
y.create.l HWIO_EMAC_0_EMAC_QSERDES_COM_PLLLOCK_CMP_EN_ADDR A:0x7c58050
y.create.l HWIO_EMAC_0_EMAC_QSERDES_COM_RES_TRIM_OFFSET_ADDR A:0x7c58054
y.create.l HWIO_EMAC_0_EMAC_QSERDES_COM_BGTC_ADDR A:0x7c58058
y.create.l HWIO_EMAC_0_EMAC_QSERDES_COM_PLL_TEST_UPDN_RESTRIMSTEP_ADDR A:0x7c5805c
y.create.l HWIO_EMAC_0_EMAC_QSERDES_COM_PLL_VCO_TUNE_ADDR A:0x7c58060
y.create.l HWIO_EMAC_0_EMAC_QSERDES_COM_DEC_START1_ADDR A:0x7c58064
y.create.l HWIO_EMAC_0_EMAC_QSERDES_COM_PLL_AMP_OS_ADDR A:0x7c58068
y.create.l HWIO_EMAC_0_EMAC_QSERDES_COM_SSC_EN_CENTER_ADDR A:0x7c5806c
y.create.l HWIO_EMAC_0_EMAC_QSERDES_COM_SSC_ADJ_PER1_ADDR A:0x7c58070
y.create.l HWIO_EMAC_0_EMAC_QSERDES_COM_SSC_ADJ_PER2_ADDR A:0x7c58074
y.create.l HWIO_EMAC_0_EMAC_QSERDES_COM_SSC_PER1_ADDR A:0x7c58078
y.create.l HWIO_EMAC_0_EMAC_QSERDES_COM_SSC_PER2_ADDR A:0x7c5807c
y.create.l HWIO_EMAC_0_EMAC_QSERDES_COM_SSC_STEP_SIZE1_ADDR A:0x7c58080
y.create.l HWIO_EMAC_0_EMAC_QSERDES_COM_SSC_STEP_SIZE2_ADDR A:0x7c58084
y.create.l HWIO_EMAC_0_EMAC_QSERDES_COM_RES_TRIM_SEARCH_ADDR A:0x7c58088
y.create.l HWIO_EMAC_0_EMAC_QSERDES_COM_RES_TRIM_FREEZE_ADDR A:0x7c5808c
y.create.l HWIO_EMAC_0_EMAC_QSERDES_COM_RES_TRIM_EN_VCOCALDONE_ADDR A:0x7c58090
y.create.l HWIO_EMAC_0_EMAC_QSERDES_COM_FAUX_EN_ADDR A:0x7c58094
y.create.l HWIO_EMAC_0_EMAC_QSERDES_COM_DIV_FRAC_START1_ADDR A:0x7c58098
y.create.l HWIO_EMAC_0_EMAC_QSERDES_COM_DIV_FRAC_START2_ADDR A:0x7c5809c
y.create.l HWIO_EMAC_0_EMAC_QSERDES_COM_DIV_FRAC_START3_ADDR A:0x7c580a0
y.create.l HWIO_EMAC_0_EMAC_QSERDES_COM_DEC_START2_ADDR A:0x7c580a4
y.create.l HWIO_EMAC_0_EMAC_QSERDES_COM_PLL_RXTXEPCLK_EN_ADDR A:0x7c580a8
y.create.l HWIO_EMAC_0_EMAC_QSERDES_COM_PLL_CRCTRL_ADDR A:0x7c580ac
y.create.l HWIO_EMAC_0_EMAC_QSERDES_COM_PLL_CLKEPDIV_ADDR A:0x7c580b0
y.create.l HWIO_EMAC_0_EMAC_QSERDES_COM_PLL_FREQUPDATE_ADDR A:0x7c580b4
y.create.l HWIO_EMAC_0_EMAC_QSERDES_COM_PLL_VCO_HIGH_ADDR A:0x7c580b8
y.create.l HWIO_EMAC_0_EMAC_QSERDES_COM_RESET_SM_ADDR A:0x7c580bc
y.create.l HWIO_EMAC_0_EMAC_QSERDES_TX_BIST_MODE_LANENO_ADDR A:0x7c58100
y.create.l HWIO_EMAC_0_EMAC_QSERDES_TX_CLKBUF_ENABLE_ADDR A:0x7c58104
y.create.l HWIO_EMAC_0_EMAC_QSERDES_TX_TX_EMP_POST1_LVL_ADDR A:0x7c58108
y.create.l HWIO_EMAC_0_EMAC_QSERDES_TX_TX_DRV_LVL_ADDR A:0x7c5810c
y.create.l HWIO_EMAC_0_EMAC_QSERDES_TX_RESET_TSYNC_EN_ADDR A:0x7c58110
y.create.l HWIO_EMAC_0_EMAC_QSERDES_TX_LPB_EN_ADDR A:0x7c58114
y.create.l HWIO_EMAC_0_EMAC_QSERDES_TX_RES_CODE_ADDR A:0x7c58118
y.create.l HWIO_EMAC_0_EMAC_QSERDES_TX_PERL_LENGTH1_ADDR A:0x7c5811c
y.create.l HWIO_EMAC_0_EMAC_QSERDES_TX_PERL_LENGTH2_ADDR A:0x7c58120
y.create.l HWIO_EMAC_0_EMAC_QSERDES_TX_SERDES_BYP_EN_OUT_ADDR A:0x7c58124
y.create.l HWIO_EMAC_0_EMAC_QSERDES_TX_HIGHZ_TRANSCEIVEREN_BIAS_EN_ADDR A:0x7c58128
y.create.l HWIO_EMAC_0_EMAC_QSERDES_TX_PARRATE_REC_DETECT_IDLE_EN_ADDR A:0x7c5812c
y.create.l HWIO_EMAC_0_EMAC_QSERDES_TX_BIST_PATTERN1_ADDR A:0x7c58130
y.create.l HWIO_EMAC_0_EMAC_QSERDES_TX_BIST_PATTERN2_ADDR A:0x7c58134
y.create.l HWIO_EMAC_0_EMAC_QSERDES_TX_BIST_PATTERN3_ADDR A:0x7c58138
y.create.l HWIO_EMAC_0_EMAC_QSERDES_TX_BIST_PATTERN4_ADDR A:0x7c5813c
y.create.l HWIO_EMAC_0_EMAC_QSERDES_TX_BIST_PATTERN5_ADDR A:0x7c58140
y.create.l HWIO_EMAC_0_EMAC_QSERDES_TX_BIST_PATTERN6_ADDR A:0x7c58144
y.create.l HWIO_EMAC_0_EMAC_QSERDES_TX_BIST_PATTERN7_ADDR A:0x7c58148
y.create.l HWIO_EMAC_0_EMAC_QSERDES_TX_BIST_PATTERN8_ADDR A:0x7c5814c
y.create.l HWIO_EMAC_0_EMAC_QSERDES_TX_LANE_MODE_ADDR A:0x7c58150
y.create.l HWIO_EMAC_0_EMAC_QSERDES_TX_ATB_SEL_ADDR A:0x7c58154
y.create.l HWIO_EMAC_0_EMAC_QSERDES_TX_REC_DETECT_LVL_ADDR A:0x7c58158
y.create.l HWIO_EMAC_0_EMAC_QSERDES_TX_PRBS_SEED1_ADDR A:0x7c5815c
y.create.l HWIO_EMAC_0_EMAC_QSERDES_TX_PRBS_SEED2_ADDR A:0x7c58160
y.create.l HWIO_EMAC_0_EMAC_QSERDES_TX_PRBS_SEED3_ADDR A:0x7c58164
y.create.l HWIO_EMAC_0_EMAC_QSERDES_TX_PRBS_SEED4_ADDR A:0x7c58168
y.create.l HWIO_EMAC_0_EMAC_QSERDES_TX_RESET_GEN_ADDR A:0x7c5816c
y.create.l HWIO_EMAC_0_EMAC_QSERDES_TX_TRAN_DRVR_EMP_EN_ADDR A:0x7c58170
y.create.l HWIO_EMAC_0_EMAC_QSERDES_TX_TX_INTERFACE_MODE_ADDR A:0x7c58174
y.create.l HWIO_EMAC_0_EMAC_QSERDES_TX_BIST_STATUS_ADDR A:0x7c58178
y.create.l HWIO_EMAC_0_EMAC_QSERDES_TX_BIST_ERROR_COUNT1_ADDR A:0x7c5817c
y.create.l HWIO_EMAC_0_EMAC_QSERDES_TX_BIST_ERROR_COUNT2_ADDR A:0x7c58180
y.create.l HWIO_EMAC_0_EMAC_QSERDES_RX_CDR_CONTROL_ADDR A:0x7c58200
y.create.l HWIO_EMAC_0_EMAC_QSERDES_RX_AUX_CONTROL_ADDR A:0x7c58204
y.create.l HWIO_EMAC_0_EMAC_QSERDES_RX_AUX_DATA_TCODE_ADDR A:0x7c58208
y.create.l HWIO_EMAC_0_EMAC_QSERDES_RX_RCLK_AUXDATA_SEL_ADDR A:0x7c5820c
y.create.l HWIO_EMAC_0_EMAC_QSERDES_RX_CDR_CONTROL2_ADDR A:0x7c58210
y.create.l HWIO_EMAC_0_EMAC_QSERDES_RX_AC_JTAG_INITP_ADDR A:0x7c58214
y.create.l HWIO_EMAC_0_EMAC_QSERDES_RX_AC_JTAG_INITN_ADDR A:0x7c58218
y.create.l HWIO_EMAC_0_EMAC_QSERDES_RX_AC_JTAG_LVL_EN_ADDR A:0x7c5821c
y.create.l HWIO_EMAC_0_EMAC_QSERDES_RX_AC_JTAG_MODE_ADDR A:0x7c58220
y.create.l HWIO_EMAC_0_EMAC_QSERDES_RX_AC_JTAG_RESET_ADDR A:0x7c58224
y.create.l HWIO_EMAC_0_EMAC_QSERDES_RX_RX_IQ_RXDET_EN_ADDR A:0x7c58228
y.create.l HWIO_EMAC_0_EMAC_QSERDES_RX_RX_TERM_HIGHZ_CM_AC_COUPLE_ADDR A:0x7c5822c
y.create.l HWIO_EMAC_0_EMAC_QSERDES_RX_RX_EQ_GAIN12_ADDR A:0x7c58230
y.create.l HWIO_EMAC_0_EMAC_QSERDES_RX_SIGDET_CNTRL_ADDR A:0x7c58234
y.create.l HWIO_EMAC_0_EMAC_QSERDES_RX_RX_BAND_ADDR A:0x7c58238
y.create.l HWIO_EMAC_0_EMAC_QSERDES_RX_CDR_FREEZE_UP_DN_ADDR A:0x7c5823c
y.create.l HWIO_EMAC_0_EMAC_QSERDES_RX_RX_INTERFACE_MODE_ADDR A:0x7c58240
y.create.l HWIO_EMAC_0_EMAC_QSERDES_RX_JITTER_GEN_MODE_ADDR A:0x7c58244
y.create.l HWIO_EMAC_0_EMAC_QSERDES_RX_BUJ_AMP_ADDR A:0x7c58248
y.create.l HWIO_EMAC_0_EMAC_QSERDES_RX_SJ_AMP1_ADDR A:0x7c5824c
y.create.l HWIO_EMAC_0_EMAC_QSERDES_RX_SJ_AMP2_ADDR A:0x7c58250
y.create.l HWIO_EMAC_0_EMAC_QSERDES_RX_SJ_PER1_ADDR A:0x7c58254
y.create.l HWIO_EMAC_0_EMAC_QSERDES_RX_SJ_PER2_ADDR A:0x7c58258
y.create.l HWIO_EMAC_0_EMAC_QSERDES_RX_BUJ_STEP_FREQ1_ADDR A:0x7c5825c
y.create.l HWIO_EMAC_0_EMAC_QSERDES_RX_BUJ_STEP_FREQ2_ADDR A:0x7c58260
y.create.l HWIO_EMAC_0_EMAC_QSERDES_RX_PPM_OFFSET1_ADDR A:0x7c58264
y.create.l HWIO_EMAC_0_EMAC_QSERDES_RX_PPM_OFFSET2_ADDR A:0x7c58268
y.create.l HWIO_EMAC_0_EMAC_QSERDES_RX_SIGN_PPM_PERIOD1_ADDR A:0x7c5826c
y.create.l HWIO_EMAC_0_EMAC_QSERDES_RX_SIGN_PPM_PERIOD2_ADDR A:0x7c58270
y.create.l HWIO_EMAC_0_EMAC_QSERDES_RX_SSC_CTRL_ADDR A:0x7c58274
y.create.l HWIO_EMAC_0_EMAC_QSERDES_RX_SSC_COUNT1_ADDR A:0x7c58278
y.create.l HWIO_EMAC_0_EMAC_QSERDES_RX_SSC_COUNT2_ADDR A:0x7c5827c
y.create.l HWIO_EMAC_0_EMAC_QSERDES_RX_PWM_CNTRL1_ADDR A:0x7c58280
y.create.l HWIO_EMAC_0_EMAC_QSERDES_RX_PWM_CNTRL2_ADDR A:0x7c58284
y.create.l HWIO_EMAC_0_EMAC_QSERDES_RX_PWM_NDIV_ADDR A:0x7c58288
y.create.l HWIO_EMAC_0_EMAC_QSERDES_RX_PI_CTRL1_ADDR A:0x7c5828c
y.create.l HWIO_EMAC_0_EMAC_QSERDES_RX_PI_CTRL2_ADDR A:0x7c58290
y.create.l HWIO_EMAC_0_EMAC_QSERDES_RX_PI_QUAD_ADDR A:0x7c58294
y.create.l HWIO_EMAC_0_EMAC_QSERDES_RX_IDATA1_ADDR A:0x7c58298
y.create.l HWIO_EMAC_0_EMAC_QSERDES_RX_IDATA2_ADDR A:0x7c5829c
y.create.l HWIO_EMAC_0_EMAC_QSERDES_RX_AUX_DATA1_ADDR A:0x7c582a0
y.create.l HWIO_EMAC_0_EMAC_QSERDES_RX_AUX_DATA2_ADDR A:0x7c582a4
y.create.l HWIO_EMAC_0_EMAC_QSERDES_RX_AC_JTAG_OUTP_ADDR A:0x7c582a8
y.create.l HWIO_EMAC_0_EMAC_QSERDES_RX_AC_JTAG_OUTN_ADDR A:0x7c582ac
y.create.l HWIO_EMAC_0_EMAC_QSERDES_RX_RX_SIGDET_PWMDECSTATUS_ADDR A:0x7c582b0
y.create.l HWIO_EMAC_0_EMAC_SGMII_PHY_SERDES_START_ADDR A:0x7c58300
y.create.l HWIO_EMAC_0_EMAC_SGMII_PHY_CMN_PWR_CTRL_ADDR A:0x7c58304
y.create.l HWIO_EMAC_0_EMAC_SGMII_PHY_RX_PWR_CTRL_ADDR A:0x7c58308
y.create.l HWIO_EMAC_0_EMAC_SGMII_PHY_TX_PWR_CTRL_ADDR A:0x7c5830c
y.create.l HWIO_EMAC_0_EMAC_SGMII_PHY_CMN_CTRL_ADDR A:0x7c58310
y.create.l HWIO_EMAC_0_EMAC_SGMII_PHY_LANE_CTRL0_ADDR A:0x7c58314
y.create.l HWIO_EMAC_0_EMAC_SGMII_PHY_LANE_CTRL1_ADDR A:0x7c58318
y.create.l HWIO_EMAC_0_EMAC_SGMII_PHY_PRBS_CFG0_ADDR A:0x7c5831c
y.create.l HWIO_EMAC_0_EMAC_SGMII_PHY_PRBS_CFG1_ADDR A:0x7c58320
y.create.l HWIO_EMAC_0_EMAC_SGMII_PHY_PRBS_CFG2_ADDR A:0x7c58324
y.create.l HWIO_EMAC_0_EMAC_SGMII_PHY_PRBS_CFG3_ADDR A:0x7c58328
y.create.l HWIO_EMAC_0_EMAC_SGMII_PHY_PRBS_CFG4_ADDR A:0x7c5832c
y.create.l HWIO_EMAC_0_EMAC_SGMII_PHY_PRBS_CFG5_ADDR A:0x7c58330
y.create.l HWIO_EMAC_0_EMAC_SGMII_PHY_PRBS_CFG6_ADDR A:0x7c58334
y.create.l HWIO_EMAC_0_EMAC_SGMII_PHY_PRBS_CFG7_ADDR A:0x7c58338
y.create.l HWIO_EMAC_0_EMAC_SGMII_PHY_8B10B_CFG_ADDR A:0x7c5833c
y.create.l HWIO_EMAC_0_EMAC_SGMII_PHY_AUTONEG_CFG0_ADDR A:0x7c58340
y.create.l HWIO_EMAC_0_EMAC_SGMII_PHY_AUTONEG_CFG1_ADDR A:0x7c58344
y.create.l HWIO_EMAC_0_EMAC_SGMII_PHY_AUTONEG_CFG2_ADDR A:0x7c58348
y.create.l HWIO_EMAC_0_EMAC_SGMII_PHY_AUTONEG_CFG3_ADDR A:0x7c5834c
y.create.l HWIO_EMAC_0_EMAC_SGMII_PHY_AUTONEG_CFG4_ADDR A:0x7c58350
y.create.l HWIO_EMAC_0_EMAC_SGMII_PHY_CDR_CTRL0_ADDR A:0x7c58358
y.create.l HWIO_EMAC_0_EMAC_SGMII_PHY_CDR_CTRL1_ADDR A:0x7c5835c
y.create.l HWIO_EMAC_0_EMAC_SGMII_PHY_SPEED_CFG0_ADDR A:0x7c58370
y.create.l HWIO_EMAC_0_EMAC_SGMII_PHY_SPEED_CFG1_ADDR A:0x7c58374
y.create.l HWIO_EMAC_0_EMAC_SGMII_PHY_POW_DWN_CTRL0_ADDR A:0x7c58380
y.create.l HWIO_EMAC_0_EMAC_SGMII_PHY_TX_DATA_CTRL_ADDR A:0x7c58388
y.create.l HWIO_EMAC_0_EMAC_SGMII_PHY_BIST_GEN0_ADDR A:0x7c5838c
y.create.l HWIO_EMAC_0_EMAC_SGMII_PHY_BIST_GEN1_ADDR A:0x7c58390
y.create.l HWIO_EMAC_0_EMAC_SGMII_PHY_BIST_GEN2_ADDR A:0x7c58394
y.create.l HWIO_EMAC_0_EMAC_SGMII_PHY_BIST_GEN3_ADDR A:0x7c58398
y.create.l HWIO_EMAC_0_EMAC_SGMII_PHY_TEST_DEBUG_CTRL_ADDR A:0x7c583a0
y.create.l HWIO_EMAC_0_EMAC_SGMII_PHY_ALIGNP_ADDR A:0x7c583a4
y.create.l HWIO_EMAC_0_EMAC_SGMII_PHY_RESET_CTRL_ADDR A:0x7c583a8
y.create.l HWIO_EMAC_0_EMAC_SGMII_PHY_IRQ_CMD_ADDR A:0x7c583ac
y.create.l HWIO_EMAC_0_EMAC_SGMII_PHY_INTERRUPT_CLEAR_ADDR A:0x7c583b0
y.create.l HWIO_EMAC_0_EMAC_SGMII_PHY_INTERRUPT_MASK_ADDR A:0x7c583b4
y.create.l HWIO_EMAC_0_EMAC_SGMII_PHY_INTERRUPT_STATUS_ADDR A:0x7c583b8
y.create.l HWIO_EMAC_0_EMAC_SGMII_PHY_REVISION_ID0_ADDR A:0x7c583bc
y.create.l HWIO_EMAC_0_EMAC_SGMII_PHY_REVISION_ID1_ADDR A:0x7c583c0
y.create.l HWIO_EMAC_0_EMAC_SGMII_PHY_REVISION_ID2_ADDR A:0x7c583c4
y.create.l HWIO_EMAC_0_EMAC_SGMII_PHY_REVISION_ID3_ADDR A:0x7c583c8
y.create.l HWIO_EMAC_0_EMAC_SGMII_PHY_RX_CHK_ERR_CNT0_STATUS_ADDR A:0x7c583cc
y.create.l HWIO_EMAC_0_EMAC_SGMII_PHY_RX_CHK_ERR_CNT1_STATUS_ADDR A:0x7c583d0
y.create.l HWIO_EMAC_0_EMAC_SGMII_PHY_RX_CHK_STATUS_ADDR A:0x7c583d4
y.create.l HWIO_EMAC_0_EMAC_SGMII_PHY_RX_MIS_ALIGN_ERR_STATUS_ADDR A:0x7c583d8
y.create.l HWIO_EMAC_0_EMAC_SGMII_PHY_AUTONEG0_STATUS_ADDR A:0x7c583e0
y.create.l HWIO_EMAC_0_EMAC_SGMII_PHY_AUTONEG1_STATUS_ADDR A:0x7c583e4
y.create.l HWIO_EMAC_0_EMAC_SGMII_PHY_AUTONEG2_STATUS_ADDR A:0x7c583e8
y.create.l HWIO_EMAC_0_EMAC_SGMII_PHY_AUTONEG3_STATUS_ADDR A:0x7c583ec
y.create.l HWIO_EMAC_0_EMAC_SGMII_PHY_DEBUG_BUS_STAT0_ADDR A:0x7c583f0
y.create.l HWIO_EMAC_0_EMAC_SGMII_PHY_DEBUG_BUS_STAT1_ADDR A:0x7c583f4
y.create.l HWIO_EMAC_0_EMAC_SGMII_PHY_DEBUG_BUS_STAT2_ADDR A:0x7c583f8
y.create.l HWIO_EMAC_0_EMAC_SGMII_PHY_DEBUG_BUS_STAT3_ADDR A:0x7c583fc
y.create.l HWIO_MPM2_MPM_PMIC_VDD_ON_CFG_1_ADDR A:0x4a0000
y.create.l HWIO_MPM2_MPM_PMIC_VDD_ON_CFG_2_ADDR A:0x4a0004
y.create.l HWIO_MPM2_MPM_PMIC_VDD_ON_CFG_3_ADDR A:0x4a0008
y.create.l HWIO_MPM2_MPM_PMIC_VDD_ON_CFG_4_ADDR A:0x4a000c
y.create.l HWIO_MPM2_MPM_PMIC_VDD_ON_CFG_5_ADDR A:0x4a0010
y.create.l HWIO_MPM2_MPM_PMIC_VDD_ON_CFG_6_ADDR A:0x4a0014
y.create.l HWIO_MPM2_MPM_PMIC_VDD_ON_CFG_7_ADDR A:0x4a0018
y.create.l HWIO_MPM2_MPM_PMIC_VDD_ON_CFG_8_ADDR A:0x4a001c
y.create.l HWIO_MPM2_MPM_PMIC_VDD_ON_CFG_9_ADDR A:0x4a0020
y.create.l HWIO_MPM2_MPM_PMIC_VDD_ON_CFG_10_ADDR A:0x4a0024
y.create.l HWIO_MPM2_MPM_PMIC_VDD_ON_CFG_11_ADDR A:0x4a0028
y.create.l HWIO_MPM2_MPM_PMIC_VDD_ON_CFG_12_ADDR A:0x4a002c
y.create.l HWIO_MPM2_MPM_PMIC_VDD_OFF_CFG_1_ADDR A:0x4a0030
y.create.l HWIO_MPM2_MPM_PMIC_VDD_OFF_CFG_2_ADDR A:0x4a0034
y.create.l HWIO_MPM2_MPM_PMIC_VDD_OFF_CFG_3_ADDR A:0x4a0038
y.create.l HWIO_MPM2_MPM_PMIC_VDD_OFF_CFG_4_ADDR A:0x4a003c
y.create.l HWIO_MPM2_MPM_PMIC_VDD_OFF_CFG_5_ADDR A:0x4a0040
y.create.l HWIO_MPM2_MPM_PMIC_VDD_OFF_CFG_6_ADDR A:0x4a0044
y.create.l HWIO_MPM2_MPM_PMIC_VDD_OFF_CFG_7_ADDR A:0x4a0048
y.create.l HWIO_MPM2_MPM_PMIC_VDD_OFF_CFG_8_ADDR A:0x4a004c
y.create.l HWIO_MPM2_MPM_PMIC_VDD_OFF_CFG_9_ADDR A:0x4a0050
y.create.l HWIO_MPM2_MPM_PMIC_VDD_OFF_CFG_10_ADDR A:0x4a0054
y.create.l HWIO_MPM2_MPM_PMIC_VDD_OFF_CFG_11_ADDR A:0x4a0058
y.create.l HWIO_MPM2_MPM_PMIC_VDD_OFF_CFG_12_ADDR A:0x4a005c
y.create.l HWIO_MPM2_MPM_SPMI_CMD_CFG_ADDR A:0x4a0060
y.create.l HWIO_MPM2_MPM_SPMI_CDIV_CNTRL_ADDR A:0x4a0064
y.create.l HWIO_MPM2_MPM_CXO_CTRL_ADDR A:0x4a0068
y.create.l HWIO_MPM2_MPM_PXO_OSC_CTRL_ADDR A:0x4a006c
y.create.l HWIO_MPM2_MPM_LOW_POWER_CFG_ADDR A:0x4a0070
y.create.l HWIO_MPM2_MPM_LOW_POWER_STATUS_ADDR A:0x4a0074
y.create.l HWIO_MPM2_MPM_CXO_POWER_RAMPUP_TIME_ADDR A:0x4a0078
y.create.l HWIO_MPM2_MPM_PXO_WARMUP_TIME_ADDR A:0x4a007c
y.create.l HWIO_MPM2_MPM_HARDWARE_RESTORED_ADDR A:0x4a0080
y.create.l HWIO_MPM2_MPM_INT_CLEAR_1_ADDR A:0x4a0084
y.create.l HWIO_MPM2_MPM_INT_CLEAR_2_ADDR A:0x4a0088
y.create.l HWIO_MPM2_MPM_INT_EN_1_ADDR A:0x4a008c
y.create.l HWIO_MPM2_MPM_INT_EN_2_ADDR A:0x4a0090
y.create.l HWIO_MPM2_MPM_INT_POLARITY_1_ADDR A:0x4a0094
y.create.l HWIO_MPM2_MPM_INT_POLARITY_2_ADDR A:0x4a0098
y.create.l HWIO_MPM2_MPM_DETECT_CTL_1_ADDR A:0x4a009c
y.create.l HWIO_MPM2_MPM_DETECT_CTL_2_ADDR A:0x4a00a0
y.create.l HWIO_MPM2_MPM_DETECT_CTL_3_ADDR A:0x4a00a4
y.create.l HWIO_MPM2_MPM_DETECT_CTL_4_ADDR A:0x4a00a8
y.create.l HWIO_MPM2_MPM_INT_STATUS_1_ADDR A:0x4a00ac
y.create.l HWIO_MPM2_MPM_INT_STATUS_2_ADDR A:0x4a00b0
y.create.l HWIO_MPM2_MPM_INT_WKUP_CLK_SEL_1_ADDR A:0x4a00b4
y.create.l HWIO_MPM2_MPM_INT_WKUP_CLK_SEL_2_ADDR A:0x4a00b8
y.create.l HWIO_MPM2_MPM_DEBUG_BUS_EN_ADDR A:0x4a00bc
y.create.l HWIO_MPM2_MPM_PEN_DEBOUNCE_CTL_ADDR A:0x4a00c0
y.create.l HWIO_MPM2_MPM_WARM_BOOT_CFG_ADDR A:0x4a00c4
y.create.l HWIO_MPM2_MPM_REG0_FILE_ADDR A:0x4a00c8
y.create.l HWIO_MPM2_MPM_REG1_FILE_ADDR A:0x4a00cc
y.create.l HWIO_MPM2_MPM_REG2_FILE_ADDR A:0x4a00d0
y.create.l HWIO_MPM2_MPM_REG3_FILE_ADDR A:0x4a00d4
y.create.l HWIO_MPM2_MPM_REG4_FILE_ADDR A:0x4a00d8
y.create.l HWIO_MPM2_MPM_REG5_FILE_ADDR A:0x4a00dc
y.create.l HWIO_MPM2_MPM_REG6_FILE_ADDR A:0x4a00e0
y.create.l HWIO_MPM2_MPM_REG7_FILE_ADDR A:0x4a00e4
y.create.l HWIO_MPM2_MPM_REG8_FILE_ADDR A:0x4a00e8
y.create.l HWIO_MPM2_MPM_CNTR_CLK_CONTROL_ADDR A:0x4a00ec
y.create.l HWIO_MPM2_MPM_CNTR_FRAC_ADDR A:0x4a00f0
y.create.l HWIO_MPM2_MPM_CNTR_INCR_DATA_ADDR A:0x4a00f4
y.create.l HWIO_MPM2_MPM_HW_ID_ADDR A:0x4a00f8
y.create.l HWIO_MPM2_MPM_CONTROL_CNTCR_ADDR A:0x4a1000
y.create.l HWIO_MPM2_MPM_CONTROL_CNTSR_ADDR A:0x4a1004
y.create.l HWIO_MPM2_MPM_CONTROL_CNTCV_LO_ADDR A:0x4a1008
y.create.l HWIO_MPM2_MPM_CONTROL_CNTCV_HI_ADDR A:0x4a100c
y.create.l HWIO_MPM2_MPM_CONTROL_CNTFID0_ADDR A:0x4a1020
y.create.l HWIO_MPM2_MPM_CONTROL_ID_ADDR A:0x4a1fd0
y.create.l HWIO_MPM2_MPM_READ_CNTCV_LO_ADDR A:0x4a2000
y.create.l HWIO_MPM2_MPM_READ_CNTCV_HI_ADDR A:0x4a2004
y.create.l HWIO_MPM2_MPM_READ_ID_ADDR A:0x4a2fd0
y.create.l HWIO_MPM2_MPM_SLEEP_TIMETICK_COUNT_VAL_ADDR A:0x4a3000
y.create.l HWIO_MPM2_QTMR_AC_CNTFRQ_ADDR A:0x4a4000
y.create.l HWIO_MPM2_QTMR_AC_CNTSR_ADDR A:0x4a4004
y.create.l HWIO_MPM2_QTMR_AC_CNTTID_ADDR A:0x4a4008
y.create.l HWIO_MPM2_QTMR_AC_CNTACR_0_ADDR A:0x4a4040
y.create.l HWIO_MPM2_QTMR_AC_CNTVOFF_LO_0_ADDR A:0x4a4080
y.create.l HWIO_MPM2_QTMR_AC_CNTVOFF_HI_0_ADDR A:0x4a4084
y.create.l HWIO_MPM2_QTMR_AC_CFG_ADDR A:0x4a4fc0
y.create.l HWIO_MPM2_QTMR_AC_VERSION_ADDR A:0x4a4fd0
y.create.l HWIO_MPM2_QTMR_V1_CNTPCT_LO_ADDR A:0x4a5000
y.create.l HWIO_MPM2_QTMR_V1_CNTPCT_HI_ADDR A:0x4a5004
y.create.l HWIO_MPM2_QTMR_V1_CNTVCT_LO_ADDR A:0x4a5008
y.create.l HWIO_MPM2_QTMR_V1_CNTVCT_HI_ADDR A:0x4a500c
y.create.l HWIO_MPM2_QTMR_V1_CNTFRQ_ADDR A:0x4a5010
y.create.l HWIO_MPM2_QTMR_V1_CNTPL0ACR_ADDR A:0x4a5014
y.create.l HWIO_MPM2_QTMR_V1_CNTVOFF_LO_ADDR A:0x4a5018
y.create.l HWIO_MPM2_QTMR_V1_CNTVOFF_HI_ADDR A:0x4a501c
y.create.l HWIO_MPM2_QTMR_V1_CNTP_CVAL_LO_ADDR A:0x4a5020
y.create.l HWIO_MPM2_QTMR_V1_CNTP_CVAL_HI_ADDR A:0x4a5024
y.create.l HWIO_MPM2_QTMR_V1_CNTP_TVAL_ADDR A:0x4a5028
y.create.l HWIO_MPM2_QTMR_V1_CNTP_CTL_ADDR A:0x4a502c
y.create.l HWIO_MPM2_QTMR_V1_CNTV_CVAL_LO_ADDR A:0x4a5030
y.create.l HWIO_MPM2_QTMR_V1_CNTV_CVAL_HI_ADDR A:0x4a5034
y.create.l HWIO_MPM2_QTMR_V1_CNTV_TVAL_ADDR A:0x4a5038
y.create.l HWIO_MPM2_QTMR_V1_CNTV_CTL_ADDR A:0x4a503c
y.create.l HWIO_MPM2_QTMR_V1_VERSION_ADDR A:0x4a5fd0
y.create.l HWIO_MPM2_MPM_TSYNC_CTL_ADDR A:0x4a6000
y.create.l HWIO_MPM2_MPM_TSYNC_CMD_ADDR A:0x4a6004
y.create.l HWIO_MPM2_MPM_TSYNC_START_ADDR A:0x4a6008
y.create.l HWIO_MPM2_MPM_TSYNC_START_PHASE_ADDR A:0x4a600c
y.create.l HWIO_MPM2_MPM_TSYNC_PERIOD_ADDR A:0x4a6010
y.create.l HWIO_MPM2_MPM_TSYNC_PERIOD_PHASE_ADDR A:0x4a6014
y.create.l HWIO_MPM2_MPM_TSYNC_STATUS_TIME_ADDR A:0x4a6018
y.create.l HWIO_MPM2_MPM_TSYNC_STATUS_PHASE_ADDR A:0x4a601c
y.create.l HWIO_MPM2_MPM_GRFC_CXO_EN_ADDR A:0x4a6020
y.create.l HWIO_MPM2_XPU_SCR_ADDR A:0x4a7000
y.create.l HWIO_MPM2_XPU_SWDR_ADDR A:0x4a7004
y.create.l HWIO_MPM2_XPU_SEAR0_ADDR A:0x4a7040
y.create.l HWIO_MPM2_XPU_SESR_ADDR A:0x4a7048
y.create.l HWIO_MPM2_XPU_SESRRESTORE_ADDR A:0x4a704c
y.create.l HWIO_MPM2_XPU_SESYNR0_ADDR A:0x4a7050
y.create.l HWIO_MPM2_XPU_SESYNR1_ADDR A:0x4a7054
y.create.l HWIO_MPM2_XPU_SESYNR2_ADDR A:0x4a7058
y.create.l HWIO_MPM2_XPU_MCR_ADDR A:0x4a7100
y.create.l HWIO_MPM2_XPU_MEAR0_ADDR A:0x4a7140
y.create.l HWIO_MPM2_XPU_MESR_ADDR A:0x4a7148
y.create.l HWIO_MPM2_XPU_MESRRESTORE_ADDR A:0x4a714c
y.create.l HWIO_MPM2_XPU_MESYNR0_ADDR A:0x4a7150
y.create.l HWIO_MPM2_XPU_MESYNR1_ADDR A:0x4a7154
y.create.l HWIO_MPM2_XPU_MESYNR2_ADDR A:0x4a7158
y.create.l HWIO_MPM2_XPU_CR_ADDR A:0x4a7080
y.create.l HWIO_MPM2_XPU_RPU_ACR0_ADDR A:0x4a70a0
y.create.l HWIO_MPM2_XPU_EAR0_ADDR A:0x4a70c0
y.create.l HWIO_MPM2_XPU_ESR_ADDR A:0x4a70c8
y.create.l HWIO_MPM2_XPU_ESRRESTORE_ADDR A:0x4a70cc
y.create.l HWIO_MPM2_XPU_ESYNR0_ADDR A:0x4a70d0
y.create.l HWIO_MPM2_XPU_ESYNR1_ADDR A:0x4a70d4
y.create.l HWIO_MPM2_XPU_ESYNR2_ADDR A:0x4a70d8
y.create.l HWIO_MPM2_XPU_IDR0_ADDR A:0x4a7074
y.create.l HWIO_MPM2_XPU_IDR1_ADDR A:0x4a7078
y.create.l HWIO_MPM2_XPU_REV_ADDR A:0x4a707c
y.create.l HWIO_MPM2_XPU_RG0_RACR0_ADDR A:0x4a7200
y.create.l HWIO_MPM2_XPU_RG1_RACR0_ADDR A:0x4a7280
y.create.l HWIO_MPM2_XPU_RG2_RACR0_ADDR A:0x4a7300
y.create.l HWIO_MPM2_XPU_RG3_RACR0_ADDR A:0x4a7380
y.create.l HWIO_MPM2_XPU_RG4_RACR0_ADDR A:0x4a7400
y.create.l HWIO_MPM2_XPU_RG5_RACR0_ADDR A:0x4a7480
y.create.l HWIO_MPM2_XPU_RG6_RACR0_ADDR A:0x4a7500
y.create.l HWIO_MPM2_XPU_RG7_RACR0_ADDR A:0x4a7580
y.create.l HWIO_MPM2_XPU_RG8_RACR0_ADDR A:0x4a7600
y.create.l HWIO_MPM2_XPU_RG9_RACR0_ADDR A:0x4a7680
y.create.l HWIO_MPM2_XPU_RG0_SCR_ADDR A:0x4a7250
y.create.l HWIO_MPM2_XPU_RG1_SCR_ADDR A:0x4a72d0
y.create.l HWIO_MPM2_XPU_RG2_SCR_ADDR A:0x4a7350
y.create.l HWIO_MPM2_XPU_RG3_SCR_ADDR A:0x4a73d0
y.create.l HWIO_MPM2_XPU_RG4_SCR_ADDR A:0x4a7450
y.create.l HWIO_MPM2_XPU_RG5_SCR_ADDR A:0x4a74d0
y.create.l HWIO_MPM2_XPU_RG6_SCR_ADDR A:0x4a7550
y.create.l HWIO_MPM2_XPU_RG7_SCR_ADDR A:0x4a75d0
y.create.l HWIO_MPM2_XPU_RG8_SCR_ADDR A:0x4a7650
y.create.l HWIO_MPM2_XPU_RG9_SCR_ADDR A:0x4a76d0
y.create.l HWIO_MPM2_XPU_RG0_MCR_ADDR A:0x4a7254
y.create.l HWIO_MPM2_XPU_RG1_MCR_ADDR A:0x4a72d4
y.create.l HWIO_MPM2_XPU_RG2_MCR_ADDR A:0x4a7354
y.create.l HWIO_MPM2_XPU_RG3_MCR_ADDR A:0x4a73d4
y.create.l HWIO_MPM2_XPU_RG4_MCR_ADDR A:0x4a7454
y.create.l HWIO_MPM2_XPU_RG5_MCR_ADDR A:0x4a74d4
y.create.l HWIO_MPM2_XPU_RG6_MCR_ADDR A:0x4a7554
y.create.l HWIO_MPM2_XPU_RG7_MCR_ADDR A:0x4a75d4
y.create.l HWIO_MPM2_XPU_RG8_MCR_ADDR A:0x4a7654
y.create.l HWIO_MPM2_XPU_RG9_MCR_ADDR A:0x4a76d4
y.create.l HWIO_MPM2_TSENS_CTRL_ADDR A:0x4a8000
y.create.l HWIO_MPM2_TSENS_TEST_CTRL_ADDR A:0x4a8004
y.create.l HWIO_MPM2_TSENS_S0_MIN_MAX_STATUS_CTRL_ADDR A:0x4a8008
y.create.l HWIO_MPM2_TSENS_S1_MIN_MAX_STATUS_CTRL_ADDR A:0x4a800c
y.create.l HWIO_MPM2_TSENS_S2_MIN_MAX_STATUS_CTRL_ADDR A:0x4a8010
y.create.l HWIO_MPM2_TSENS_S3_MIN_MAX_STATUS_CTRL_ADDR A:0x4a8014
y.create.l HWIO_MPM2_TSENS_S4_MIN_MAX_STATUS_CTRL_ADDR A:0x4a8018
y.create.l HWIO_MPM2_TSENS_S5_MIN_MAX_STATUS_CTRL_ADDR A:0x4a801c
y.create.l HWIO_MPM2_TSENS_S6_MIN_MAX_STATUS_CTRL_ADDR A:0x4a8020
y.create.l HWIO_MPM2_TSENS_S7_MIN_MAX_STATUS_CTRL_ADDR A:0x4a8024
y.create.l HWIO_MPM2_TSENS_S8_MIN_MAX_STATUS_CTRL_ADDR A:0x4a8028
y.create.l HWIO_MPM2_TSENS_S9_MIN_MAX_STATUS_CTRL_ADDR A:0x4a802c
y.create.l HWIO_MPM2_TSENS_GLOBAL_CONFIG_ADDR A:0x4a8034
y.create.l HWIO_MPM2_TSENS_S0_MAIN_CONFIG_ADDR A:0x4a8038
y.create.l HWIO_MPM2_TSENS_S1_REMOTE_CONFIG_ADDR A:0x4a8040
y.create.l HWIO_MPM2_TSENS_S2_REMOTE_CONFIG_ADDR A:0x4a8044
y.create.l HWIO_MPM2_TSENS_S3_REMOTE_CONFIG_ADDR A:0x4a8048
y.create.l HWIO_MPM2_TSENS_S4_REMOTE_CONFIG_ADDR A:0x4a804c
y.create.l HWIO_MPM2_TSENS_S5_REMOTE_CONFIG_ADDR A:0x4a8050
y.create.l HWIO_MPM2_TSENS_S6_REMOTE_CONFIG_ADDR A:0x4a8054
y.create.l HWIO_MPM2_TSENS_S7_REMOTE_CONFIG_ADDR A:0x4a8058
y.create.l HWIO_MPM2_TSENS_S8_REMOTE_CONFIG_ADDR A:0x4a805c
y.create.l HWIO_MPM2_TSENS_S9_REMOTE_CONFIG_ADDR A:0x4a8060
y.create.l HWIO_MPM2_TSENS_S10_REMOTE_CONFIG_ADDR A:0x4a8064
y.create.l HWIO_MPM2_TSENS_UPPER_LOWER_INTERRUPT_CTRL_ADDR A:0x4a9000
y.create.l HWIO_MPM2_TSENS_S0_UPPER_LOWER_STATUS_CTRL_ADDR A:0x4a9004
y.create.l HWIO_MPM2_TSENS_S1_UPPER_LOWER_STATUS_CTRL_ADDR A:0x4a9008
y.create.l HWIO_MPM2_TSENS_S2_UPPER_LOWER_STATUS_CTRL_ADDR A:0x4a900c
y.create.l HWIO_MPM2_TSENS_S3_UPPER_LOWER_STATUS_CTRL_ADDR A:0x4a9010
y.create.l HWIO_MPM2_TSENS_S4_UPPER_LOWER_STATUS_CTRL_ADDR A:0x4a9014
y.create.l HWIO_MPM2_TSENS_S5_UPPER_LOWER_STATUS_CTRL_ADDR A:0x4a9018
y.create.l HWIO_MPM2_TSENS_S6_UPPER_LOWER_STATUS_CTRL_ADDR A:0x4a901c
y.create.l HWIO_MPM2_TSENS_S7_UPPER_LOWER_STATUS_CTRL_ADDR A:0x4a9020
y.create.l HWIO_MPM2_TSENS_S8_UPPER_LOWER_STATUS_CTRL_ADDR A:0x4a9024
y.create.l HWIO_MPM2_TSENS_S9_UPPER_LOWER_STATUS_CTRL_ADDR A:0x4a9028
y.create.l HWIO_MPM2_TSENS_S0_STATUS_ADDR A:0x4a9030
y.create.l HWIO_MPM2_TSENS_S1_STATUS_ADDR A:0x4a9034
y.create.l HWIO_MPM2_TSENS_S2_STATUS_ADDR A:0x4a9038
y.create.l HWIO_MPM2_TSENS_S3_STATUS_ADDR A:0x4a903c
y.create.l HWIO_MPM2_TSENS_S4_STATUS_ADDR A:0x4a9040
y.create.l HWIO_MPM2_TSENS_S5_STATUS_ADDR A:0x4a9044
y.create.l HWIO_MPM2_TSENS_S6_STATUS_ADDR A:0x4a9048
y.create.l HWIO_MPM2_TSENS_S7_STATUS_ADDR A:0x4a904c
y.create.l HWIO_MPM2_TSENS_S8_STATUS_ADDR A:0x4a9050
y.create.l HWIO_MPM2_TSENS_S9_STATUS_ADDR A:0x4a9054
y.create.l HWIO_MPM2_TSENS_TRDY_ADDR A:0x4a905c
y.create.l HWIO_MPM2_WDOG_RESET_REG_ADDR A:0x4aa000
y.create.l HWIO_MPM2_WDOG_CTL_REG_ADDR A:0x4aa004
y.create.l HWIO_MPM2_WDOG_STATUS_REG_ADDR A:0x4aa008
y.create.l HWIO_MPM2_WDOG_BARK_VAL_REG_ADDR A:0x4aa00c
y.create.l HWIO_MPM2_WDOG_BITE_VAL_REG_ADDR A:0x4aa010
y.create.l HWIO_MPM2_MPM_PS_HOLD_ADDR A:0x4ab000
y.create.l HWIO_MPM2_MPM_DDR_PHY_FREEZEIO_EBI1_ADDR A:0x4ab004
y.create.l HWIO_MSS_XPU_SCR_ADDR A:0x4000000
y.create.l HWIO_MSS_XPU_SWDR_ADDR A:0x4000004
y.create.l HWIO_MSS_XPU_SEAR0_ADDR A:0x4000040
y.create.l HWIO_MSS_XPU_SESR_ADDR A:0x4000048
y.create.l HWIO_MSS_XPU_SESRRESTORE_ADDR A:0x400004c
y.create.l HWIO_MSS_XPU_SESYNR0_ADDR A:0x4000050
y.create.l HWIO_MSS_XPU_SESYNR1_ADDR A:0x4000054
y.create.l HWIO_MSS_XPU_SESYNR2_ADDR A:0x4000058
y.create.l HWIO_MSS_XPU_MCR_ADDR A:0x4000100
y.create.l HWIO_MSS_XPU_MEAR0_ADDR A:0x4000140
y.create.l HWIO_MSS_XPU_MESR_ADDR A:0x4000148
y.create.l HWIO_MSS_XPU_MESRRESTORE_ADDR A:0x400014c
y.create.l HWIO_MSS_XPU_MESYNR0_ADDR A:0x4000150
y.create.l HWIO_MSS_XPU_MESYNR1_ADDR A:0x4000154
y.create.l HWIO_MSS_XPU_MESYNR2_ADDR A:0x4000158
y.create.l HWIO_MSS_XPU_CR_ADDR A:0x4000080
y.create.l HWIO_MSS_XPU_RPU_ACR0_ADDR A:0x40000a0
y.create.l HWIO_MSS_XPU_EAR0_ADDR A:0x40000c0
y.create.l HWIO_MSS_XPU_ESR_ADDR A:0x40000c8
y.create.l HWIO_MSS_XPU_ESRRESTORE_ADDR A:0x40000cc
y.create.l HWIO_MSS_XPU_ESYNR0_ADDR A:0x40000d0
y.create.l HWIO_MSS_XPU_ESYNR1_ADDR A:0x40000d4
y.create.l HWIO_MSS_XPU_ESYNR2_ADDR A:0x40000d8
y.create.l HWIO_MSS_XPU_IDR0_ADDR A:0x4000074
y.create.l HWIO_MSS_XPU_IDR1_ADDR A:0x4000078
y.create.l HWIO_MSS_XPU_REV_ADDR A:0x400007c
y.create.l HWIO_MSS_XPU_RG0_RACR0_ADDR A:0x4000200
y.create.l HWIO_MSS_XPU_RG1_RACR0_ADDR A:0x4000280
y.create.l HWIO_MSS_XPU_RG2_RACR0_ADDR A:0x4000300
y.create.l HWIO_MSS_XPU_RG3_RACR0_ADDR A:0x4000380
y.create.l HWIO_MSS_XPU_RG4_RACR0_ADDR A:0x4000400
y.create.l HWIO_MSS_XPU_RG0_SCR_ADDR A:0x4000250
y.create.l HWIO_MSS_XPU_RG1_SCR_ADDR A:0x40002d0
y.create.l HWIO_MSS_XPU_RG2_SCR_ADDR A:0x4000350
y.create.l HWIO_MSS_XPU_RG3_SCR_ADDR A:0x40003d0
y.create.l HWIO_MSS_XPU_RG4_SCR_ADDR A:0x4000450
y.create.l HWIO_MSS_XPU_RG0_MCR_ADDR A:0x4000254
y.create.l HWIO_MSS_XPU_RG1_MCR_ADDR A:0x40002d4
y.create.l HWIO_MSS_XPU_RG2_MCR_ADDR A:0x4000354
y.create.l HWIO_MSS_XPU_RG3_MCR_ADDR A:0x40003d4
y.create.l HWIO_MSS_XPU_RG4_MCR_ADDR A:0x4000454
y.create.l HWIO_MSS_RELAY_MSG_BUFFER_00_ADDR A:0x4020000
y.create.l HWIO_MSS_RELAY_MSG_BUFFER_01_ADDR A:0x4020004
y.create.l HWIO_MSS_RELAY_MSG_BUFFER_02_ADDR A:0x4020008
y.create.l HWIO_MSS_RELAY_MSG_BUFFER_03_ADDR A:0x402000c
y.create.l HWIO_MSS_RELAY_MSG_BUFFER_04_ADDR A:0x4020010
y.create.l HWIO_MSS_RELAY_MSG_BUFFER_05_ADDR A:0x4020014
y.create.l HWIO_MSS_RELAY_MSG_BUFFER_06_ADDR A:0x4020018
y.create.l HWIO_MSS_RELAY_MSG_BUFFER_07_ADDR A:0x402001c
y.create.l HWIO_MSS_RELAY_MSG_BUFFER_08_ADDR A:0x4020020
y.create.l HWIO_MSS_RELAY_MSG_BUFFER_09_ADDR A:0x4020024
y.create.l HWIO_MSS_RELAY_MSG_BUFFER_10_ADDR A:0x4020028
y.create.l HWIO_MSS_RELAY_MSG_BUFFER_11_ADDR A:0x402002c
y.create.l HWIO_MSS_RELAY_MSG_BUFFER_12_ADDR A:0x4020030
y.create.l HWIO_MSS_RELAY_MSG_BUFFER_13_ADDR A:0x4020034
y.create.l HWIO_MSS_RELAY_MSG_BUFFER_14_ADDR A:0x4020038
y.create.l HWIO_MSS_RELAY_MSG_BUFFER_15_ADDR A:0x402003c
y.create.l HWIO_MSS_BAM_CTRL_ADDR A:0x4044000
y.create.l HWIO_MSS_BAM_TIMER_ADDR A:0x4044040
y.create.l HWIO_MSS_BAM_TIMER_CTRL_ADDR A:0x4044044
y.create.l HWIO_MSS_BAM_DESC_CNT_TRSHLD_ADDR A:0x4044008
y.create.l HWIO_MSS_BAM_IRQ_STTS_ADDR A:0x4044014
y.create.l HWIO_MSS_BAM_IRQ_CLR_ADDR A:0x4044018
y.create.l HWIO_MSS_BAM_IRQ_EN_ADDR A:0x404401c
y.create.l HWIO_MSS_BAM_CNFG_BITS_ADDR A:0x404407c
y.create.l HWIO_MSS_BAM_CNFG_BITS_2_ADDR A:0x4044084
y.create.l HWIO_MSS_BAM_REVISION_ADDR A:0x4045000
y.create.l HWIO_MSS_BAM_SW_VERSION_ADDR A:0x4045004
y.create.l HWIO_MSS_BAM_NUM_PIPES_ADDR A:0x4045008
y.create.l HWIO_MSS_BAM_TEST_BUS_SEL_ADDR A:0x4045010
y.create.l HWIO_MSS_BAM_TEST_BUS_REG_ADDR A:0x4045014
y.create.l HWIO_MSS_BAM_AHB_MASTER_ERR_CTRLS_ADDR A:0x4045024
y.create.l HWIO_MSS_BAM_AHB_MASTER_ERR_ADDR_ADDR A:0x4045028
y.create.l HWIO_MSS_BAM_AHB_MASTER_ERR_DATA_ADDR A:0x404502c
y.create.l HWIO_MSS_BAM_AHB_MASTER_ERR_ADDR_LSB_ADDR A:0x4045100
y.create.l HWIO_MSS_BAM_AHB_MASTER_ERR_ADDR_MSB_ADDR A:0x4045104
y.create.l HWIO_MSS_BAM_TRUST_REG_ADDR A:0x4046000
y.create.l HWIO_MSS_BAM_P_TRUST_REG0_ADDR A:0x4046020
y.create.l HWIO_MSS_BAM_P_TRUST_REG1_ADDR A:0x4046024
y.create.l HWIO_MSS_BAM_P_TRUST_REG2_ADDR A:0x4046028
y.create.l HWIO_MSS_BAM_P_TRUST_REG3_ADDR A:0x404602c
y.create.l HWIO_MSS_BAM_P_TRUST_REG4_ADDR A:0x4046030
y.create.l HWIO_MSS_BAM_P_TRUST_REG5_ADDR A:0x4046034
y.create.l HWIO_MSS_BAM_IRQ_SRCS_EE0_ADDR A:0x4047000
y.create.l HWIO_MSS_BAM_IRQ_SRCS_EE1_ADDR A:0x4048000
y.create.l HWIO_MSS_BAM_IRQ_SRCS_EE2_ADDR A:0x4049000
y.create.l HWIO_MSS_BAM_IRQ_SRCS_EE3_ADDR A:0x404a000
y.create.l HWIO_MSS_BAM_IRQ_SRCS_EE4_ADDR A:0x404b000
y.create.l HWIO_MSS_BAM_IRQ_SRCS_EE5_ADDR A:0x404c000
y.create.l HWIO_MSS_BAM_IRQ_SRCS_EE6_ADDR A:0x404d000
y.create.l HWIO_MSS_BAM_IRQ_SRCS_EE7_ADDR A:0x404e000
y.create.l HWIO_MSS_BAM_IRQ_SRCS_MSK_EE0_ADDR A:0x4047004
y.create.l HWIO_MSS_BAM_IRQ_SRCS_MSK_EE1_ADDR A:0x4048004
y.create.l HWIO_MSS_BAM_IRQ_SRCS_MSK_EE2_ADDR A:0x4049004
y.create.l HWIO_MSS_BAM_IRQ_SRCS_MSK_EE3_ADDR A:0x404a004
y.create.l HWIO_MSS_BAM_IRQ_SRCS_MSK_EE4_ADDR A:0x404b004
y.create.l HWIO_MSS_BAM_IRQ_SRCS_MSK_EE5_ADDR A:0x404c004
y.create.l HWIO_MSS_BAM_IRQ_SRCS_MSK_EE6_ADDR A:0x404d004
y.create.l HWIO_MSS_BAM_IRQ_SRCS_MSK_EE7_ADDR A:0x404e004
y.create.l HWIO_MSS_BAM_IRQ_SRCS_UNMASKED_EE0_ADDR A:0x4047008
y.create.l HWIO_MSS_BAM_IRQ_SRCS_UNMASKED_EE1_ADDR A:0x4048008
y.create.l HWIO_MSS_BAM_IRQ_SRCS_UNMASKED_EE2_ADDR A:0x4049008
y.create.l HWIO_MSS_BAM_IRQ_SRCS_UNMASKED_EE3_ADDR A:0x404a008
y.create.l HWIO_MSS_BAM_IRQ_SRCS_UNMASKED_EE4_ADDR A:0x404b008
y.create.l HWIO_MSS_BAM_IRQ_SRCS_UNMASKED_EE5_ADDR A:0x404c008
y.create.l HWIO_MSS_BAM_IRQ_SRCS_UNMASKED_EE6_ADDR A:0x404d008
y.create.l HWIO_MSS_BAM_IRQ_SRCS_UNMASKED_EE7_ADDR A:0x404e008
y.create.l HWIO_MSS_BAM_PIPE_ATTR_EE0_ADDR A:0x404700c
y.create.l HWIO_MSS_BAM_PIPE_ATTR_EE1_ADDR A:0x404800c
y.create.l HWIO_MSS_BAM_PIPE_ATTR_EE2_ADDR A:0x404900c
y.create.l HWIO_MSS_BAM_PIPE_ATTR_EE3_ADDR A:0x404a00c
y.create.l HWIO_MSS_BAM_PIPE_ATTR_EE4_ADDR A:0x404b00c
y.create.l HWIO_MSS_BAM_PIPE_ATTR_EE5_ADDR A:0x404c00c
y.create.l HWIO_MSS_BAM_PIPE_ATTR_EE6_ADDR A:0x404d00c
y.create.l HWIO_MSS_BAM_PIPE_ATTR_EE7_ADDR A:0x404e00c
y.create.l HWIO_MSS_BAM_IRQ_SRCS_ADDR A:0x4047010
y.create.l HWIO_MSS_BAM_IRQ_SRCS_MSK_ADDR A:0x4047014
y.create.l HWIO_MSS_BAM_IRQ_SRCS_UNMASKED_ADDR A:0x4047018
y.create.l HWIO_MSS_BAM_P_CTRL0_ADDR A:0x4057000
y.create.l HWIO_MSS_BAM_P_CTRL1_ADDR A:0x4058000
y.create.l HWIO_MSS_BAM_P_CTRL2_ADDR A:0x4059000
y.create.l HWIO_MSS_BAM_P_CTRL3_ADDR A:0x405a000
y.create.l HWIO_MSS_BAM_P_CTRL4_ADDR A:0x405b000
y.create.l HWIO_MSS_BAM_P_CTRL5_ADDR A:0x405c000
y.create.l HWIO_MSS_BAM_P_RST0_ADDR A:0x4057004
y.create.l HWIO_MSS_BAM_P_RST1_ADDR A:0x4058004
y.create.l HWIO_MSS_BAM_P_RST2_ADDR A:0x4059004
y.create.l HWIO_MSS_BAM_P_RST3_ADDR A:0x405a004
y.create.l HWIO_MSS_BAM_P_RST4_ADDR A:0x405b004
y.create.l HWIO_MSS_BAM_P_RST5_ADDR A:0x405c004
y.create.l HWIO_MSS_BAM_P_HALT0_ADDR A:0x4057008
y.create.l HWIO_MSS_BAM_P_HALT1_ADDR A:0x4058008
y.create.l HWIO_MSS_BAM_P_HALT2_ADDR A:0x4059008
y.create.l HWIO_MSS_BAM_P_HALT3_ADDR A:0x405a008
y.create.l HWIO_MSS_BAM_P_HALT4_ADDR A:0x405b008
y.create.l HWIO_MSS_BAM_P_HALT5_ADDR A:0x405c008
y.create.l HWIO_MSS_BAM_P_IRQ_STTS0_ADDR A:0x4057010
y.create.l HWIO_MSS_BAM_P_IRQ_STTS1_ADDR A:0x4058010
y.create.l HWIO_MSS_BAM_P_IRQ_STTS2_ADDR A:0x4059010
y.create.l HWIO_MSS_BAM_P_IRQ_STTS3_ADDR A:0x405a010
y.create.l HWIO_MSS_BAM_P_IRQ_STTS4_ADDR A:0x405b010
y.create.l HWIO_MSS_BAM_P_IRQ_STTS5_ADDR A:0x405c010
y.create.l HWIO_MSS_BAM_P_IRQ_CLR0_ADDR A:0x4057014
y.create.l HWIO_MSS_BAM_P_IRQ_CLR1_ADDR A:0x4058014
y.create.l HWIO_MSS_BAM_P_IRQ_CLR2_ADDR A:0x4059014
y.create.l HWIO_MSS_BAM_P_IRQ_CLR3_ADDR A:0x405a014
y.create.l HWIO_MSS_BAM_P_IRQ_CLR4_ADDR A:0x405b014
y.create.l HWIO_MSS_BAM_P_IRQ_CLR5_ADDR A:0x405c014
y.create.l HWIO_MSS_BAM_P_IRQ_EN0_ADDR A:0x4057018
y.create.l HWIO_MSS_BAM_P_IRQ_EN1_ADDR A:0x4058018
y.create.l HWIO_MSS_BAM_P_IRQ_EN2_ADDR A:0x4059018
y.create.l HWIO_MSS_BAM_P_IRQ_EN3_ADDR A:0x405a018
y.create.l HWIO_MSS_BAM_P_IRQ_EN4_ADDR A:0x405b018
y.create.l HWIO_MSS_BAM_P_IRQ_EN5_ADDR A:0x405c018
y.create.l HWIO_MSS_BAM_P_TIMER0_ADDR A:0x405701c
y.create.l HWIO_MSS_BAM_P_TIMER1_ADDR A:0x405801c
y.create.l HWIO_MSS_BAM_P_TIMER2_ADDR A:0x405901c
y.create.l HWIO_MSS_BAM_P_TIMER3_ADDR A:0x405a01c
y.create.l HWIO_MSS_BAM_P_TIMER4_ADDR A:0x405b01c
y.create.l HWIO_MSS_BAM_P_TIMER5_ADDR A:0x405c01c
y.create.l HWIO_MSS_BAM_P_TIMER_CTRL0_ADDR A:0x4057020
y.create.l HWIO_MSS_BAM_P_TIMER_CTRL1_ADDR A:0x4058020
y.create.l HWIO_MSS_BAM_P_TIMER_CTRL2_ADDR A:0x4059020
y.create.l HWIO_MSS_BAM_P_TIMER_CTRL3_ADDR A:0x405a020
y.create.l HWIO_MSS_BAM_P_TIMER_CTRL4_ADDR A:0x405b020
y.create.l HWIO_MSS_BAM_P_TIMER_CTRL5_ADDR A:0x405c020
y.create.l HWIO_MSS_BAM_P_PRDCR_SDBND0_ADDR A:0x4057024
y.create.l HWIO_MSS_BAM_P_PRDCR_SDBND1_ADDR A:0x4058024
y.create.l HWIO_MSS_BAM_P_PRDCR_SDBND2_ADDR A:0x4059024
y.create.l HWIO_MSS_BAM_P_PRDCR_SDBND3_ADDR A:0x405a024
y.create.l HWIO_MSS_BAM_P_PRDCR_SDBND4_ADDR A:0x405b024
y.create.l HWIO_MSS_BAM_P_PRDCR_SDBND5_ADDR A:0x405c024
y.create.l HWIO_MSS_BAM_P_CNSMR_SDBND0_ADDR A:0x4057028
y.create.l HWIO_MSS_BAM_P_CNSMR_SDBND1_ADDR A:0x4058028
y.create.l HWIO_MSS_BAM_P_CNSMR_SDBND2_ADDR A:0x4059028
y.create.l HWIO_MSS_BAM_P_CNSMR_SDBND3_ADDR A:0x405a028
y.create.l HWIO_MSS_BAM_P_CNSMR_SDBND4_ADDR A:0x405b028
y.create.l HWIO_MSS_BAM_P_CNSMR_SDBND5_ADDR A:0x405c028
y.create.l HWIO_MSS_BAM_P_SW_OFSTS0_ADDR A:0x4057800
y.create.l HWIO_MSS_BAM_P_SW_OFSTS1_ADDR A:0x4058800
y.create.l HWIO_MSS_BAM_P_SW_OFSTS2_ADDR A:0x4059800
y.create.l HWIO_MSS_BAM_P_SW_OFSTS3_ADDR A:0x405a800
y.create.l HWIO_MSS_BAM_P_SW_OFSTS4_ADDR A:0x405b800
y.create.l HWIO_MSS_BAM_P_SW_OFSTS5_ADDR A:0x405c800
y.create.l HWIO_MSS_BAM_P_AU_PSM_CNTXT_1_0_ADDR A:0x4057804
y.create.l HWIO_MSS_BAM_P_AU_PSM_CNTXT_1_1_ADDR A:0x4058804
y.create.l HWIO_MSS_BAM_P_AU_PSM_CNTXT_1_2_ADDR A:0x4059804
y.create.l HWIO_MSS_BAM_P_AU_PSM_CNTXT_1_3_ADDR A:0x405a804
y.create.l HWIO_MSS_BAM_P_AU_PSM_CNTXT_1_4_ADDR A:0x405b804
y.create.l HWIO_MSS_BAM_P_AU_PSM_CNTXT_1_5_ADDR A:0x405c804
y.create.l HWIO_MSS_BAM_P_PSM_CNTXT_2_0_ADDR A:0x4057808
y.create.l HWIO_MSS_BAM_P_PSM_CNTXT_2_1_ADDR A:0x4058808
y.create.l HWIO_MSS_BAM_P_PSM_CNTXT_2_2_ADDR A:0x4059808
y.create.l HWIO_MSS_BAM_P_PSM_CNTXT_2_3_ADDR A:0x405a808
y.create.l HWIO_MSS_BAM_P_PSM_CNTXT_2_4_ADDR A:0x405b808
y.create.l HWIO_MSS_BAM_P_PSM_CNTXT_2_5_ADDR A:0x405c808
y.create.l HWIO_MSS_BAM_P_PSM_CNTXT_3_0_ADDR A:0x405780c
y.create.l HWIO_MSS_BAM_P_PSM_CNTXT_3_1_ADDR A:0x405880c
y.create.l HWIO_MSS_BAM_P_PSM_CNTXT_3_2_ADDR A:0x405980c
y.create.l HWIO_MSS_BAM_P_PSM_CNTXT_3_3_ADDR A:0x405a80c
y.create.l HWIO_MSS_BAM_P_PSM_CNTXT_3_4_ADDR A:0x405b80c
y.create.l HWIO_MSS_BAM_P_PSM_CNTXT_3_5_ADDR A:0x405c80c
y.create.l HWIO_MSS_BAM_P_PSM_CNTXT_4_0_ADDR A:0x4057810
y.create.l HWIO_MSS_BAM_P_PSM_CNTXT_4_1_ADDR A:0x4058810
y.create.l HWIO_MSS_BAM_P_PSM_CNTXT_4_2_ADDR A:0x4059810
y.create.l HWIO_MSS_BAM_P_PSM_CNTXT_4_3_ADDR A:0x405a810
y.create.l HWIO_MSS_BAM_P_PSM_CNTXT_4_4_ADDR A:0x405b810
y.create.l HWIO_MSS_BAM_P_PSM_CNTXT_4_5_ADDR A:0x405c810
y.create.l HWIO_MSS_BAM_P_PSM_CNTXT_5_0_ADDR A:0x4057814
y.create.l HWIO_MSS_BAM_P_PSM_CNTXT_5_1_ADDR A:0x4058814
y.create.l HWIO_MSS_BAM_P_PSM_CNTXT_5_2_ADDR A:0x4059814
y.create.l HWIO_MSS_BAM_P_PSM_CNTXT_5_3_ADDR A:0x405a814
y.create.l HWIO_MSS_BAM_P_PSM_CNTXT_5_4_ADDR A:0x405b814
y.create.l HWIO_MSS_BAM_P_PSM_CNTXT_5_5_ADDR A:0x405c814
y.create.l HWIO_MSS_BAM_P_EVNT_REG0_ADDR A:0x4057818
y.create.l HWIO_MSS_BAM_P_EVNT_REG1_ADDR A:0x4058818
y.create.l HWIO_MSS_BAM_P_EVNT_REG2_ADDR A:0x4059818
y.create.l HWIO_MSS_BAM_P_EVNT_REG3_ADDR A:0x405a818
y.create.l HWIO_MSS_BAM_P_EVNT_REG4_ADDR A:0x405b818
y.create.l HWIO_MSS_BAM_P_EVNT_REG5_ADDR A:0x405c818
y.create.l HWIO_MSS_BAM_P_DESC_FIFO_ADDR0_ADDR A:0x405781c
y.create.l HWIO_MSS_BAM_P_DESC_FIFO_ADDR1_ADDR A:0x405881c
y.create.l HWIO_MSS_BAM_P_DESC_FIFO_ADDR2_ADDR A:0x405981c
y.create.l HWIO_MSS_BAM_P_DESC_FIFO_ADDR3_ADDR A:0x405a81c
y.create.l HWIO_MSS_BAM_P_DESC_FIFO_ADDR4_ADDR A:0x405b81c
y.create.l HWIO_MSS_BAM_P_DESC_FIFO_ADDR5_ADDR A:0x405c81c
y.create.l HWIO_MSS_BAM_P_FIFO_SIZES0_ADDR A:0x4057820
y.create.l HWIO_MSS_BAM_P_FIFO_SIZES1_ADDR A:0x4058820
y.create.l HWIO_MSS_BAM_P_FIFO_SIZES2_ADDR A:0x4059820
y.create.l HWIO_MSS_BAM_P_FIFO_SIZES3_ADDR A:0x405a820
y.create.l HWIO_MSS_BAM_P_FIFO_SIZES4_ADDR A:0x405b820
y.create.l HWIO_MSS_BAM_P_FIFO_SIZES5_ADDR A:0x405c820
y.create.l HWIO_MSS_BAM_P_DATA_FIFO_ADDR0_ADDR A:0x4057824
y.create.l HWIO_MSS_BAM_P_DATA_FIFO_ADDR1_ADDR A:0x4058824
y.create.l HWIO_MSS_BAM_P_DATA_FIFO_ADDR2_ADDR A:0x4059824
y.create.l HWIO_MSS_BAM_P_DATA_FIFO_ADDR3_ADDR A:0x405a824
y.create.l HWIO_MSS_BAM_P_DATA_FIFO_ADDR4_ADDR A:0x405b824
y.create.l HWIO_MSS_BAM_P_DATA_FIFO_ADDR5_ADDR A:0x405c824
y.create.l HWIO_MSS_BAM_P_EVNT_GEN_TRSHLD0_ADDR A:0x4057828
y.create.l HWIO_MSS_BAM_P_EVNT_GEN_TRSHLD1_ADDR A:0x4058828
y.create.l HWIO_MSS_BAM_P_EVNT_GEN_TRSHLD2_ADDR A:0x4059828
y.create.l HWIO_MSS_BAM_P_EVNT_GEN_TRSHLD3_ADDR A:0x405a828
y.create.l HWIO_MSS_BAM_P_EVNT_GEN_TRSHLD4_ADDR A:0x405b828
y.create.l HWIO_MSS_BAM_P_EVNT_GEN_TRSHLD5_ADDR A:0x405c828
y.create.l HWIO_MSS_BAM_P_EVNT_DEST_ADDR0_ADDR A:0x405782c
y.create.l HWIO_MSS_BAM_P_EVNT_DEST_ADDR1_ADDR A:0x405882c
y.create.l HWIO_MSS_BAM_P_EVNT_DEST_ADDR2_ADDR A:0x405982c
y.create.l HWIO_MSS_BAM_P_EVNT_DEST_ADDR3_ADDR A:0x405a82c
y.create.l HWIO_MSS_BAM_P_EVNT_DEST_ADDR4_ADDR A:0x405b82c
y.create.l HWIO_MSS_BAM_P_EVNT_DEST_ADDR5_ADDR A:0x405c82c
y.create.l HWIO_MSS_BAM_P_DF_CNTXT_0_ADDR A:0x4057830
y.create.l HWIO_MSS_BAM_P_DF_CNTXT_1_ADDR A:0x4058830
y.create.l HWIO_MSS_BAM_P_DF_CNTXT_2_ADDR A:0x4059830
y.create.l HWIO_MSS_BAM_P_DF_CNTXT_3_ADDR A:0x405a830
y.create.l HWIO_MSS_BAM_P_DF_CNTXT_4_ADDR A:0x405b830
y.create.l HWIO_MSS_BAM_P_DF_CNTXT_5_ADDR A:0x405c830
y.create.l HWIO_MSS_BAM_P_RETR_CNTXT_0_ADDR A:0x4057834
y.create.l HWIO_MSS_BAM_P_RETR_CNTXT_1_ADDR A:0x4058834
y.create.l HWIO_MSS_BAM_P_RETR_CNTXT_2_ADDR A:0x4059834
y.create.l HWIO_MSS_BAM_P_RETR_CNTXT_3_ADDR A:0x405a834
y.create.l HWIO_MSS_BAM_P_RETR_CNTXT_4_ADDR A:0x405b834
y.create.l HWIO_MSS_BAM_P_RETR_CNTXT_5_ADDR A:0x405c834
y.create.l HWIO_MSS_BAM_P_SI_CNTXT_0_ADDR A:0x4057838
y.create.l HWIO_MSS_BAM_P_SI_CNTXT_1_ADDR A:0x4058838
y.create.l HWIO_MSS_BAM_P_SI_CNTXT_2_ADDR A:0x4059838
y.create.l HWIO_MSS_BAM_P_SI_CNTXT_3_ADDR A:0x405a838
y.create.l HWIO_MSS_BAM_P_SI_CNTXT_4_ADDR A:0x405b838
y.create.l HWIO_MSS_BAM_P_SI_CNTXT_5_ADDR A:0x405c838
y.create.l HWIO_MSS_BAM_P_PSM_CNTXT_3_LSB0_ADDR A:0x4057900
y.create.l HWIO_MSS_BAM_P_PSM_CNTXT_3_LSB1_ADDR A:0x4058900
y.create.l HWIO_MSS_BAM_P_PSM_CNTXT_3_LSB2_ADDR A:0x4059900
y.create.l HWIO_MSS_BAM_P_PSM_CNTXT_3_LSB3_ADDR A:0x405a900
y.create.l HWIO_MSS_BAM_P_PSM_CNTXT_3_LSB4_ADDR A:0x405b900
y.create.l HWIO_MSS_BAM_P_PSM_CNTXT_3_LSB5_ADDR A:0x405c900
y.create.l HWIO_MSS_BAM_P_PSM_CNTXT_3_MSB0_ADDR A:0x4057904
y.create.l HWIO_MSS_BAM_P_PSM_CNTXT_3_MSB1_ADDR A:0x4058904
y.create.l HWIO_MSS_BAM_P_PSM_CNTXT_3_MSB2_ADDR A:0x4059904
y.create.l HWIO_MSS_BAM_P_PSM_CNTXT_3_MSB3_ADDR A:0x405a904
y.create.l HWIO_MSS_BAM_P_PSM_CNTXT_3_MSB4_ADDR A:0x405b904
y.create.l HWIO_MSS_BAM_P_PSM_CNTXT_3_MSB5_ADDR A:0x405c904
y.create.l HWIO_MSS_BAM_P_DESC_FIFO_ADDR_LSB0_ADDR A:0x4057910
y.create.l HWIO_MSS_BAM_P_DESC_FIFO_ADDR_LSB1_ADDR A:0x4058910
y.create.l HWIO_MSS_BAM_P_DESC_FIFO_ADDR_LSB2_ADDR A:0x4059910
y.create.l HWIO_MSS_BAM_P_DESC_FIFO_ADDR_LSB3_ADDR A:0x405a910
y.create.l HWIO_MSS_BAM_P_DESC_FIFO_ADDR_LSB4_ADDR A:0x405b910
y.create.l HWIO_MSS_BAM_P_DESC_FIFO_ADDR_LSB5_ADDR A:0x405c910
y.create.l HWIO_MSS_BAM_P_DESC_FIFO_ADDR_MSB0_ADDR A:0x4057914
y.create.l HWIO_MSS_BAM_P_DESC_FIFO_ADDR_MSB1_ADDR A:0x4058914
y.create.l HWIO_MSS_BAM_P_DESC_FIFO_ADDR_MSB2_ADDR A:0x4059914
y.create.l HWIO_MSS_BAM_P_DESC_FIFO_ADDR_MSB3_ADDR A:0x405a914
y.create.l HWIO_MSS_BAM_P_DESC_FIFO_ADDR_MSB4_ADDR A:0x405b914
y.create.l HWIO_MSS_BAM_P_DESC_FIFO_ADDR_MSB5_ADDR A:0x405c914
y.create.l HWIO_MSS_BAM_P_DATA_FIFO_ADDR_LSB0_ADDR A:0x4057920
y.create.l HWIO_MSS_BAM_P_DATA_FIFO_ADDR_LSB1_ADDR A:0x4058920
y.create.l HWIO_MSS_BAM_P_DATA_FIFO_ADDR_LSB2_ADDR A:0x4059920
y.create.l HWIO_MSS_BAM_P_DATA_FIFO_ADDR_LSB3_ADDR A:0x405a920
y.create.l HWIO_MSS_BAM_P_DATA_FIFO_ADDR_LSB4_ADDR A:0x405b920
y.create.l HWIO_MSS_BAM_P_DATA_FIFO_ADDR_LSB5_ADDR A:0x405c920
y.create.l HWIO_MSS_BAM_P_DATA_FIFO_ADDR_MSB0_ADDR A:0x4057924
y.create.l HWIO_MSS_BAM_P_DATA_FIFO_ADDR_MSB1_ADDR A:0x4058924
y.create.l HWIO_MSS_BAM_P_DATA_FIFO_ADDR_MSB2_ADDR A:0x4059924
y.create.l HWIO_MSS_BAM_P_DATA_FIFO_ADDR_MSB3_ADDR A:0x405a924
y.create.l HWIO_MSS_BAM_P_DATA_FIFO_ADDR_MSB4_ADDR A:0x405b924
y.create.l HWIO_MSS_BAM_P_DATA_FIFO_ADDR_MSB5_ADDR A:0x405c924
y.create.l HWIO_MSS_BAM_P_EVNT_DEST_ADDR_LSB0_ADDR A:0x4057930
y.create.l HWIO_MSS_BAM_P_EVNT_DEST_ADDR_LSB1_ADDR A:0x4058930
y.create.l HWIO_MSS_BAM_P_EVNT_DEST_ADDR_LSB2_ADDR A:0x4059930
y.create.l HWIO_MSS_BAM_P_EVNT_DEST_ADDR_LSB3_ADDR A:0x405a930
y.create.l HWIO_MSS_BAM_P_EVNT_DEST_ADDR_LSB4_ADDR A:0x405b930
y.create.l HWIO_MSS_BAM_P_EVNT_DEST_ADDR_LSB5_ADDR A:0x405c930
y.create.l HWIO_MSS_BAM_P_EVNT_DEST_ADDR_MSB0_ADDR A:0x4057934
y.create.l HWIO_MSS_BAM_P_EVNT_DEST_ADDR_MSB1_ADDR A:0x4058934
y.create.l HWIO_MSS_BAM_P_EVNT_DEST_ADDR_MSB2_ADDR A:0x4059934
y.create.l HWIO_MSS_BAM_P_EVNT_DEST_ADDR_MSB3_ADDR A:0x405a934
y.create.l HWIO_MSS_BAM_P_EVNT_DEST_ADDR_MSB4_ADDR A:0x405b934
y.create.l HWIO_MSS_BAM_P_EVNT_DEST_ADDR_MSB5_ADDR A:0x405c934
y.create.l HWIO_MSS_QDSP6SS_VERSION_ADDR A:0x4080000
y.create.l HWIO_MSS_QDSP6SS_CONFIG_ID_ADDR A:0x4080004
y.create.l HWIO_MSS_QDSP6SS_RST_EVB_ADDR A:0x4080010
y.create.l HWIO_MSS_QDSP6SS_RESET_ADDR A:0x4080014
y.create.l HWIO_MSS_QDSP6SS_DBG_CFG_ADDR A:0x4080018
y.create.l HWIO_MSS_QDSP6SS_RET_CFG_ADDR A:0x408001c
y.create.l HWIO_MSS_QDSP6SS_GFMUX_CTL_ADDR A:0x4080020
y.create.l HWIO_MSS_QDSP6SS_GFMUX_STATUS_ADDR A:0x4080024
y.create.l HWIO_MSS_QDSP6SS_CORE_CMD_RCGR_ADDR A:0x4080028
y.create.l HWIO_MSS_QDSP6SS_CORE_CFG_RCGR_ADDR A:0x408002c
y.create.l HWIO_MSS_QDSP6SS_PWR_CTL_ADDR A:0x4080030
y.create.l HWIO_MSS_QDSP6SS_CGC_OVERRIDE_ADDR A:0x4080034
y.create.l HWIO_MSS_QDSP6SS_XO_CBCR_ADDR A:0x4080038
y.create.l HWIO_MSS_QDSP6SS_SLEEP_CBCR_ADDR A:0x408003c
y.create.l HWIO_MSS_QDSP6SS_NMI_ADDR A:0x4080040
y.create.l HWIO_MSS_QDSP6SS_NMI_STATUS_ADDR A:0x4080044
y.create.l HWIO_MSS_QDSP6SS_CLOCK_SPDM_MON_ADDR A:0x4080048
y.create.l HWIO_MSS_QDSP6SS_STATERET_CTL_ADDR A:0x408004c
y.create.l HWIO_MSS_QDSP6SS_BHS_CTL_ADDR A:0x4080074
y.create.l HWIO_MSS_QDSP6SS_BHS_STATUS_ADDR A:0x4080078
y.create.l HWIO_MSS_QDSP6SS_QMC_SVS_CTL_ADDR A:0x408007c
y.create.l HWIO_MSS_QDSP6SS_SPM_SW_TRIG_ADDR A:0x4080080
y.create.l HWIO_MSS_QDSP6SS_SPM_TRIG_STATUS_ADDR A:0x4080084
y.create.l HWIO_MSS_QDSP6SS_INTF_HALTREQ_ADDR A:0x4080088
y.create.l HWIO_MSS_QDSP6SS_INTF_HALTACK_ADDR A:0x408008c
y.create.l HWIO_MSS_QDSP6SS_INTFCLAMP_SET_ADDR A:0x4080090
y.create.l HWIO_MSS_QDSP6SS_INTFCLAMP_CLEAR_ADDR A:0x4080094
y.create.l HWIO_MSS_QDSP6SS_INTFCLAMP_STATUS_ADDR A:0x4080098
y.create.l HWIO_MSS_QDSP6SS_INTF_FIFO_RESET_ADDR A:0x40800a0
y.create.l HWIO_MSS_QDSP6SS_MEM_PWR_CTL_ADDR A:0x40800b0
y.create.l HWIO_MSS_QDSP6SS_L1S_PWR_CTL_ADDR A:0x40800b4
y.create.l HWIO_MSS_QDSP6SS_L1S2_PWR_CTL_ADDR A:0x40800b8
y.create.l HWIO_MSS_QDSP6SS_CP_PWR_CTL_ADDR A:0x40800c0
y.create.l HWIO_MSS_QDSP6SS_CP_PWR_STATUS_ADDR A:0x40800c4
y.create.l HWIO_MSS_QDSP6SS_CP_RESET_ADDR A:0x40800c8
y.create.l HWIO_MSS_QDSP6SS_CP_CLK_CTL_ADDR A:0x40800cc
y.create.l HWIO_MSS_QDSP6SS_CP2_PWR_CTL_ADDR A:0x40800d0
y.create.l HWIO_MSS_QDSP6SS_CP2_PWR_STATUS_ADDR A:0x40800d4
y.create.l HWIO_MSS_QDSP6SS_CP2_RESET_ADDR A:0x40800d8
y.create.l HWIO_MSS_QDSP6SS_CP2_CLK_CTL_ADDR A:0x40800dc
y.create.l HWIO_MSS_QDSP6SS_STRAP_TCM_ADDR A:0x4080100
y.create.l HWIO_MSS_QDSP6SS_STRAP_AHBUPPER_ADDR A:0x4080104
y.create.l HWIO_MSS_QDSP6SS_STRAP_AHBLOWER_ADDR A:0x4080108
y.create.l HWIO_MSS_QDSP6SS_STRAP_ACC_ADDR A:0x4080110
y.create.l HWIO_MSS_QDSP6SS_STRAP_QMC_ACC_ADDR A:0x4080114
y.create.l HWIO_MSS_QDSP6SS_DCC_CTRL_ADDR A:0x4080118
y.create.l HWIO_MSS_QDSP6SS_STRAP_AXIM2UPPER_ADDR A:0x408011c
y.create.l HWIO_MSS_QDSP6SS_STRAP_AXIM2LOWER_ADDR A:0x4080120
y.create.l HWIO_MSS_QDSP6SS_PLL_MODE_ADDR A:0x4080200
y.create.l HWIO_MSS_QDSP6SS_PLL_L_VAL_ADDR A:0x4080204
y.create.l HWIO_MSS_QDSP6SS_PLL_ALPHA_VAL_ADDR A:0x4080208
y.create.l HWIO_MSS_QDSP6SS_PLL_ALPHA_VAL_U_ADDR A:0x408020c
y.create.l HWIO_MSS_QDSP6SS_PLL_USER_CTL_ADDR A:0x4080210
y.create.l HWIO_MSS_QDSP6SS_PLL_USER_CTL_U_ADDR A:0x4080214
y.create.l HWIO_MSS_QDSP6SS_PLL_CONFIG_CTL_ADDR A:0x4080218
y.create.l HWIO_MSS_QDSP6SS_PLL_TEST_CTL_ADDR A:0x408021c
y.create.l HWIO_MSS_QDSP6SS_PLL_TEST_CTL_U_ADDR A:0x4080220
y.create.l HWIO_MSS_QDSP6SS_PLL_STATUS_ADDR A:0x4080224
y.create.l HWIO_MSS_QDSP6SS_PLL_FREQ_CTL_ADDR A:0x4080228
y.create.l HWIO_MSS_QDSP6SS_PLL_RCG_UPDATE_CFG_ADDR A:0x4080240
y.create.l HWIO_MSS_QDSP6SS_PLL_RCG_UPDATE_DLYCTL_ADDR A:0x4080244
y.create.l HWIO_MSS_QDSP6SS_PLL_RCG_UPDATE_CMD_ADDR A:0x4080248
y.create.l HWIO_MSS_QDSP6SS_PLL_RCG_UPDATE_STATUS_ADDR A:0x408023c
y.create.l HWIO_MSS_QDSP6SS_EXT_WAKEUP_ADDR A:0x4081000
y.create.l HWIO_MSS_QDSP6SS_EXT_PD_ADDR A:0x4081004
y.create.l HWIO_MSS_QDSP6SS_TEST_BUS_CTL_ADDR A:0x4082000
y.create.l HWIO_MSS_QDSP6SS_TEST_BUS_VALUE_ADDR A:0x4082004
y.create.l HWIO_MSS_QDSP6SS_TEST_BUS_WDATA_ADDR A:0x4082008
y.create.l HWIO_MSS_QDSP6SS_PWRDBG_CTL_ADDR A:0x408200c
y.create.l HWIO_MSS_QDSP6SS_TEST_CLK_CTL_ADDR A:0x4082010
y.create.l HWIO_MSS_QDSP6SS_PWRDBG_STATUS_ADDR A:0x4082014
y.create.l HWIO_MSS_QDSP6SS_ZMEAS_CONFIG_ADDR A:0x4082018
y.create.l HWIO_MSS_QDSP6SS_CORE_STATUS_ADDR A:0x4082028
y.create.l HWIO_QDSP6SS_INSTANCE_ID_ADDR A:0x4100000
y.create.l HWIO_QDSP6SS_IDLT_MATCH_VAL_ADDR A:0x4101000
y.create.l HWIO_QDSP6SS_IDLT_COUNT_VAL_ADDR A:0x4101004
y.create.l HWIO_QDSP6SS_IDLT_ENABLE_ADDR A:0x4101008
y.create.l HWIO_QDSP6SS_IDLT_SYNC_STATUS_ADDR A:0x410100c
y.create.l HWIO_QDSP6SS_WDOG_RESET_ADDR A:0x4102000
y.create.l HWIO_QDSP6SS_WDOG_CTL_ADDR A:0x4102004
y.create.l HWIO_QDSP6SS_WDOG_STATUS_ADDR A:0x4102008
y.create.l HWIO_QDSP6SS_WDOG_BARK_TIME_ADDR A:0x410200c
y.create.l HWIO_QDSP6SS_WDOG_BITE_TIME_ADDR A:0x4102010
y.create.l HWIO_QDSP6SS_WDOG_NMI_TIME_ADDR A:0x4102014
y.create.l HWIO_QDSP6SS_WDOG_TEST_LOAD_ADDR A:0x4102018
y.create.l HWIO_QDSP6SS_WDOG_TEST_ADDR A:0x410201c
y.create.l HWIO_QDSP6SS_IPC_ADDR A:0x4105000
y.create.l HWIO_QDSP6SS_IPC1_ADDR A:0x4105004
y.create.l HWIO_QDSP6SS_BLOCK_INTR_ADDR A:0x4107008
y.create.l HWIO_QDSP6SS_PD_HS_START_ADDR A:0x410700c
y.create.l HWIO_QDSP6SS_PD_HS_DONE_ADDR A:0x4107010
y.create.l HWIO_QDSP6SS_PU_HS_START_ADDR A:0x4107014
y.create.l HWIO_QDSP6SS_SLPC_CFG_ADDR A:0x410701c
y.create.l HWIO_QDSP6SS_SLPC_STATUS_ADDR A:0x4107020
y.create.l HWIO_QDSP6SS_L2VIC_WAKEUP_EN_ADDR A:0x4107028
y.create.l HWIO_QDSP6SS_MVC_PWR_REQ_ADDR A:0x4107030
y.create.l HWIO_QDSP6SS_SPM_EVENT_CTL_ADDR A:0x4107050
y.create.l HWIO_QDSP6SS_SPM_TRIG_CFG0_ADDR A:0x4107080
y.create.l HWIO_QDSP6SS_SPM_TRIG_CFG1_ADDR A:0x4107084
y.create.l HWIO_QDSP6SS_SPMCTL_EN_ARES_ADDR A:0x4107100
y.create.l HWIO_QDSP6SS_SPMCTL_EN_CLAMP_ADDR A:0x4107104
y.create.l HWIO_QDSP6SS_SPMCTL_EN_CLK_ADDR A:0x4107108
y.create.l HWIO_QDSP6SS_SPMCTL_EN_MEM_ADDR A:0x410710c
y.create.l HWIO_QDSP6SS_SPMCTL_EN_BHS_ADDR A:0x4107114
y.create.l HWIO_QDSP6SS_SPMCTL_EN_LDO_ADDR A:0x4107118
y.create.l HWIO_QDSP6SS_SPMCTL_EN_EXT_ADDR A:0x410711c
y.create.l HWIO_QDSP6SS_SPMCTL_EN_PLL_ADDR A:0x4107120
y.create.l HWIO_QDSP6SS_SPMCTL_EN_STATERET_ADDR A:0x4107124
y.create.l HWIO_QDSP6SS_SPMCTL_EN_ISOINTF_CTL_ADDR A:0x4107128
y.create.l HWIO_QDSP6SS_SPMCTL_EN_ISOINTF_CLAMP_ADDR A:0x410712c
y.create.l HWIO_QDSP6SS_SPMCTL_EN_ISOINTF_CLK_ADDR A:0x4107130
y.create.l HWIO_QDSP6SS_SPMCTL_EN_MEM_L1S_ADDR A:0x4107140
y.create.l HWIO_QDSP6SS_SPMCTL_EN_ARES_SET_ADDR A:0x4107180
y.create.l HWIO_QDSP6SS_SPMCTL_EN_CLAMP_SET_ADDR A:0x4107184
y.create.l HWIO_QDSP6SS_SPMCTL_EN_CLK_SET_ADDR A:0x4107188
y.create.l HWIO_QDSP6SS_SPMCTL_EN_MEM_SET_ADDR A:0x410718c
y.create.l HWIO_QDSP6SS_SPMCTL_EN_BHS_SET_ADDR A:0x4107194
y.create.l HWIO_QDSP6SS_SPMCTL_EN_LDO_SET_ADDR A:0x4107198
y.create.l HWIO_QDSP6SS_SPMCTL_EN_EXT_SET_ADDR A:0x410719c
y.create.l HWIO_QDSP6SS_SPMCTL_EN_PLL_SET_ADDR A:0x41071a0
y.create.l HWIO_QDSP6SS_SPMCTL_EN_STATERET_SET_ADDR A:0x41071a4
y.create.l HWIO_QDSP6SS_SPMCTL_EN_ISOINTF_CTL_SET_ADDR A:0x41071a8
y.create.l HWIO_QDSP6SS_SPMCTL_EN_ISOINTF_CLAMP_SET_ADDR A:0x41071ac
y.create.l HWIO_QDSP6SS_SPMCTL_EN_ISOINTF_CLK_SET_ADDR A:0x41071b0
y.create.l HWIO_QDSP6SS_SPMCTL_EN_MEM_L1S_SET_ADDR A:0x41071c0
y.create.l HWIO_QDSP6SS_SPMCTL_EN_ARES_CLEAR_ADDR A:0x4107200
y.create.l HWIO_QDSP6SS_SPMCTL_EN_CLAMP_CLEAR_ADDR A:0x4107204
y.create.l HWIO_QDSP6SS_SPMCTL_EN_CLK_CLEAR_ADDR A:0x4107208
y.create.l HWIO_QDSP6SS_SPMCTL_EN_MEM_CLEAR_ADDR A:0x410720c
y.create.l HWIO_QDSP6SS_SPMCTL_EN_BHS_CLEAR_ADDR A:0x4107214
y.create.l HWIO_QDSP6SS_SPMCTL_EN_LDO_CLEAR_ADDR A:0x4107218
y.create.l HWIO_QDSP6SS_SPMCTL_EN_EXT_CLEAR_ADDR A:0x410721c
y.create.l HWIO_QDSP6SS_SPMCTL_EN_PLL_CLEAR_ADDR A:0x4107220
y.create.l HWIO_QDSP6SS_SPMCTL_EN_STATERET_CLEAR_ADDR A:0x4107224
y.create.l HWIO_QDSP6SS_SPMCTL_EN_ISOINTF_CTL_CLEAR_ADDR A:0x4107228
y.create.l HWIO_QDSP6SS_SPMCTL_EN_ISOINTF_CLAMP_CLEAR_ADDR A:0x410722c
y.create.l HWIO_QDSP6SS_SPMCTL_EN_ISOINTF_CLK_CLEAR_ADDR A:0x4107230
y.create.l HWIO_QDSP6SS_SPMCTL_EN_MEM_L1S_CLEAR_ADDR A:0x4107240
y.create.l HWIO_QDSP6SS_L2VIC_VID_ADDR A:0x4110000
y.create.l HWIO_QDSP6SS_L2VIC_INT_ENABLE0_ADDR A:0x4110100
y.create.l HWIO_QDSP6SS_L2VIC_INT_ENABLE1_ADDR A:0x4110104
y.create.l HWIO_QDSP6SS_L2VIC_INT_ENABLE2_ADDR A:0x4110108
y.create.l HWIO_QDSP6SS_L2VIC_INT_ENABLE3_ADDR A:0x411010c
y.create.l HWIO_QDSP6SS_L2VIC_INT_ENABLE4_ADDR A:0x4110110
y.create.l HWIO_QDSP6SS_L2VIC_INT_ENABLE5_ADDR A:0x4110114
y.create.l HWIO_QDSP6SS_L2VIC_INT_ENABLE6_ADDR A:0x4110118
y.create.l HWIO_QDSP6SS_L2VIC_INT_ENABLE7_ADDR A:0x411011c
y.create.l HWIO_QDSP6SS_L2VIC_INT_ENABLE8_ADDR A:0x4110120
y.create.l HWIO_QDSP6SS_L2VIC_INT_ENABLE9_ADDR A:0x4110124
y.create.l HWIO_QDSP6SS_L2VIC_INT_ENABLE_CLEAR0_ADDR A:0x4110180
y.create.l HWIO_QDSP6SS_L2VIC_INT_ENABLE_CLEAR1_ADDR A:0x4110184
y.create.l HWIO_QDSP6SS_L2VIC_INT_ENABLE_CLEAR2_ADDR A:0x4110188
y.create.l HWIO_QDSP6SS_L2VIC_INT_ENABLE_CLEAR3_ADDR A:0x411018c
y.create.l HWIO_QDSP6SS_L2VIC_INT_ENABLE_CLEAR4_ADDR A:0x4110190
y.create.l HWIO_QDSP6SS_L2VIC_INT_ENABLE_CLEAR5_ADDR A:0x4110194
y.create.l HWIO_QDSP6SS_L2VIC_INT_ENABLE_CLEAR6_ADDR A:0x4110198
y.create.l HWIO_QDSP6SS_L2VIC_INT_ENABLE_CLEAR7_ADDR A:0x411019c
y.create.l HWIO_QDSP6SS_L2VIC_INT_ENABLE_CLEAR8_ADDR A:0x41101a0
y.create.l HWIO_QDSP6SS_L2VIC_INT_ENABLE_CLEAR9_ADDR A:0x41101a4
y.create.l HWIO_QDSP6SS_L2VIC_INT_ENABLE_SET0_ADDR A:0x4110200
y.create.l HWIO_QDSP6SS_L2VIC_INT_ENABLE_SET1_ADDR A:0x4110204
y.create.l HWIO_QDSP6SS_L2VIC_INT_ENABLE_SET2_ADDR A:0x4110208
y.create.l HWIO_QDSP6SS_L2VIC_INT_ENABLE_SET3_ADDR A:0x411020c
y.create.l HWIO_QDSP6SS_L2VIC_INT_ENABLE_SET4_ADDR A:0x4110210
y.create.l HWIO_QDSP6SS_L2VIC_INT_ENABLE_SET5_ADDR A:0x4110214
y.create.l HWIO_QDSP6SS_L2VIC_INT_ENABLE_SET6_ADDR A:0x4110218
y.create.l HWIO_QDSP6SS_L2VIC_INT_ENABLE_SET7_ADDR A:0x411021c
y.create.l HWIO_QDSP6SS_L2VIC_INT_ENABLE_SET8_ADDR A:0x4110220
y.create.l HWIO_QDSP6SS_L2VIC_INT_ENABLE_SET9_ADDR A:0x4110224
y.create.l HWIO_QDSP6SS_L2VIC_INT_TYPE0_ADDR A:0x4110280
y.create.l HWIO_QDSP6SS_L2VIC_INT_TYPE1_ADDR A:0x4110284
y.create.l HWIO_QDSP6SS_L2VIC_INT_TYPE2_ADDR A:0x4110288
y.create.l HWIO_QDSP6SS_L2VIC_INT_TYPE3_ADDR A:0x411028c
y.create.l HWIO_QDSP6SS_L2VIC_INT_TYPE4_ADDR A:0x4110290
y.create.l HWIO_QDSP6SS_L2VIC_INT_TYPE5_ADDR A:0x4110294
y.create.l HWIO_QDSP6SS_L2VIC_INT_TYPE6_ADDR A:0x4110298
y.create.l HWIO_QDSP6SS_L2VIC_INT_TYPE7_ADDR A:0x411029c
y.create.l HWIO_QDSP6SS_L2VIC_INT_TYPE8_ADDR A:0x41102a0
y.create.l HWIO_QDSP6SS_L2VIC_INT_TYPE9_ADDR A:0x41102a4
y.create.l HWIO_QDSP6SS_L2VIC_INT_STATUS0_ADDR A:0x4110380
y.create.l HWIO_QDSP6SS_L2VIC_INT_STATUS1_ADDR A:0x4110384
y.create.l HWIO_QDSP6SS_L2VIC_INT_STATUS2_ADDR A:0x4110388
y.create.l HWIO_QDSP6SS_L2VIC_INT_STATUS3_ADDR A:0x411038c
y.create.l HWIO_QDSP6SS_L2VIC_INT_STATUS4_ADDR A:0x4110390
y.create.l HWIO_QDSP6SS_L2VIC_INT_STATUS5_ADDR A:0x4110394
y.create.l HWIO_QDSP6SS_L2VIC_INT_STATUS6_ADDR A:0x4110398
y.create.l HWIO_QDSP6SS_L2VIC_INT_STATUS7_ADDR A:0x411039c
y.create.l HWIO_QDSP6SS_L2VIC_INT_STATUS8_ADDR A:0x41103a0
y.create.l HWIO_QDSP6SS_L2VIC_INT_STATUS9_ADDR A:0x41103a4
y.create.l HWIO_QDSP6SS_L2VIC_INT_CLEAR0_ADDR A:0x4110400
y.create.l HWIO_QDSP6SS_L2VIC_INT_CLEAR1_ADDR A:0x4110404
y.create.l HWIO_QDSP6SS_L2VIC_INT_CLEAR2_ADDR A:0x4110408
y.create.l HWIO_QDSP6SS_L2VIC_INT_CLEAR3_ADDR A:0x411040c
y.create.l HWIO_QDSP6SS_L2VIC_INT_CLEAR4_ADDR A:0x4110410
y.create.l HWIO_QDSP6SS_L2VIC_INT_CLEAR5_ADDR A:0x4110414
y.create.l HWIO_QDSP6SS_L2VIC_INT_CLEAR6_ADDR A:0x4110418
y.create.l HWIO_QDSP6SS_L2VIC_INT_CLEAR7_ADDR A:0x411041c
y.create.l HWIO_QDSP6SS_L2VIC_INT_CLEAR8_ADDR A:0x4110420
y.create.l HWIO_QDSP6SS_L2VIC_INT_CLEAR9_ADDR A:0x4110424
y.create.l HWIO_QDSP6SS_L2VIC_SOFT_INT0_ADDR A:0x4110480
y.create.l HWIO_QDSP6SS_L2VIC_SOFT_INT1_ADDR A:0x4110484
y.create.l HWIO_QDSP6SS_L2VIC_SOFT_INT2_ADDR A:0x4110488
y.create.l HWIO_QDSP6SS_L2VIC_SOFT_INT3_ADDR A:0x411048c
y.create.l HWIO_QDSP6SS_L2VIC_SOFT_INT4_ADDR A:0x4110490
y.create.l HWIO_QDSP6SS_L2VIC_SOFT_INT5_ADDR A:0x4110494
y.create.l HWIO_QDSP6SS_L2VIC_SOFT_INT6_ADDR A:0x4110498
y.create.l HWIO_QDSP6SS_L2VIC_SOFT_INT7_ADDR A:0x411049c
y.create.l HWIO_QDSP6SS_L2VIC_SOFT_INT8_ADDR A:0x41104a0
y.create.l HWIO_QDSP6SS_L2VIC_SOFT_INT9_ADDR A:0x41104a4
y.create.l HWIO_QDSP6SS_L2VIC_INT_PENDING0_ADDR A:0x4110500
y.create.l HWIO_QDSP6SS_L2VIC_INT_PENDING1_ADDR A:0x4110504
y.create.l HWIO_QDSP6SS_L2VIC_INT_PENDING2_ADDR A:0x4110508
y.create.l HWIO_QDSP6SS_L2VIC_INT_PENDING3_ADDR A:0x411050c
y.create.l HWIO_QDSP6SS_L2VIC_INT_PENDING4_ADDR A:0x4110510
y.create.l HWIO_QDSP6SS_L2VIC_INT_PENDING5_ADDR A:0x4110514
y.create.l HWIO_QDSP6SS_L2VIC_INT_PENDING6_ADDR A:0x4110518
y.create.l HWIO_QDSP6SS_L2VIC_INT_PENDING7_ADDR A:0x411051c
y.create.l HWIO_QDSP6SS_L2VIC_INT_PENDING8_ADDR A:0x4110520
y.create.l HWIO_QDSP6SS_L2VIC_INT_PENDING9_ADDR A:0x4110524
y.create.l HWIO_QDSP6SS_QTMR_AC_CNTFRQ_ADDR A:0x4120000
y.create.l HWIO_QDSP6SS_QTMR_AC_CNTSR_ADDR A:0x4120004
y.create.l HWIO_QDSP6SS_QTMR_AC_CNTTID_ADDR A:0x4120008
y.create.l HWIO_QDSP6SS_QTMR_AC_CNTACR_0_ADDR A:0x4120040
y.create.l HWIO_QDSP6SS_QTMR_AC_CNTACR_1_ADDR A:0x4120044
y.create.l HWIO_QDSP6SS_QTMR_AC_CNTACR_2_ADDR A:0x4120048
y.create.l HWIO_QDSP6SS_QTMR_AC_CNTVOFF_LO_0_ADDR A:0x4120080
y.create.l HWIO_QDSP6SS_QTMR_AC_CNTVOFF_LO_1_ADDR A:0x4120088
y.create.l HWIO_QDSP6SS_QTMR_AC_CNTVOFF_LO_2_ADDR A:0x4120090
y.create.l HWIO_QDSP6SS_QTMR_AC_CNTVOFF_HI_0_ADDR A:0x4120084
y.create.l HWIO_QDSP6SS_QTMR_AC_CNTVOFF_HI_1_ADDR A:0x412008c
y.create.l HWIO_QDSP6SS_QTMR_AC_CNTVOFF_HI_2_ADDR A:0x4120094
y.create.l HWIO_QDSP6SS_QTMR_AC_CFG_ADDR A:0x4120fc0
y.create.l HWIO_QDSP6SS_QTMR_AC_VERSION_ADDR A:0x4120fd0
y.create.l HWIO_QDSP6SS_QTMR_V1_CNTPCT_LO_0_ADDR A:0x4121000
y.create.l HWIO_QDSP6SS_QTMR_V1_CNTPCT_HI_0_ADDR A:0x4121004
y.create.l HWIO_QDSP6SS_QTMR_V1_CNTVCT_LO_0_ADDR A:0x4121008
y.create.l HWIO_QDSP6SS_QTMR_V1_CNTVCT_HI_0_ADDR A:0x412100c
y.create.l HWIO_QDSP6SS_QTMR_V1_CNTFRQ_0_ADDR A:0x4121010
y.create.l HWIO_QDSP6SS_QTMR_V1_CNTPL0ACR_0_ADDR A:0x4121014
y.create.l HWIO_QDSP6SS_QTMR_V1_CNTVOFF_LO_0_ADDR A:0x4121018
y.create.l HWIO_QDSP6SS_QTMR_V1_CNTVOFF_HI_0_ADDR A:0x412101c
y.create.l HWIO_QDSP6SS_QTMR_V1_CNTP_CVAL_LO_0_ADDR A:0x4121020
y.create.l HWIO_QDSP6SS_QTMR_V1_CNTP_CVAL_HI_0_ADDR A:0x4121024
y.create.l HWIO_QDSP6SS_QTMR_V1_CNTP_TVAL_0_ADDR A:0x4121028
y.create.l HWIO_QDSP6SS_QTMR_V1_CNTP_CTL_0_ADDR A:0x412102c
y.create.l HWIO_QDSP6SS_QTMR_V1_CNTV_CVAL_LO_0_ADDR A:0x4121030
y.create.l HWIO_QDSP6SS_QTMR_V1_CNTV_CVAL_HI_0_ADDR A:0x4121034
y.create.l HWIO_QDSP6SS_QTMR_V1_CNTV_TVAL_0_ADDR A:0x4121038
y.create.l HWIO_QDSP6SS_QTMR_V1_CNTV_CTL_0_ADDR A:0x412103c
y.create.l HWIO_QDSP6SS_QTMR_V1_VERSION_0_ADDR A:0x4121fd0
y.create.l HWIO_QDSP6SS_QTMR_V1_CNTPCT_LO_1_ADDR A:0x4122000
y.create.l HWIO_QDSP6SS_QTMR_V1_CNTPCT_HI_1_ADDR A:0x4122004
y.create.l HWIO_QDSP6SS_QTMR_V1_CNTVCT_LO_1_ADDR A:0x4122008
y.create.l HWIO_QDSP6SS_QTMR_V1_CNTVCT_HI_1_ADDR A:0x412200c
y.create.l HWIO_QDSP6SS_QTMR_V1_CNTFRQ_1_ADDR A:0x4122010
y.create.l HWIO_QDSP6SS_QTMR_V1_CNTPL0ACR_1_ADDR A:0x4122014
y.create.l HWIO_QDSP6SS_QTMR_V1_CNTVOFF_LO_1_ADDR A:0x4122018
y.create.l HWIO_QDSP6SS_QTMR_V1_CNTVOFF_HI_1_ADDR A:0x412201c
y.create.l HWIO_QDSP6SS_QTMR_V1_CNTP_CVAL_LO_1_ADDR A:0x4122020
y.create.l HWIO_QDSP6SS_QTMR_V1_CNTP_CVAL_HI_1_ADDR A:0x4122024
y.create.l HWIO_QDSP6SS_QTMR_V1_CNTP_TVAL_1_ADDR A:0x4122028
y.create.l HWIO_QDSP6SS_QTMR_V1_CNTP_CTL_1_ADDR A:0x412202c
y.create.l HWIO_QDSP6SS_QTMR_V1_CNTV_CVAL_LO_1_ADDR A:0x4122030
y.create.l HWIO_QDSP6SS_QTMR_V1_CNTV_CVAL_HI_1_ADDR A:0x4122034
y.create.l HWIO_QDSP6SS_QTMR_V1_CNTV_TVAL_1_ADDR A:0x4122038
y.create.l HWIO_QDSP6SS_QTMR_V1_CNTV_CTL_1_ADDR A:0x412203c
y.create.l HWIO_QDSP6SS_QTMR_V1_VERSION_1_ADDR A:0x4122fd0
y.create.l HWIO_QDSP6SS_QTMR_V1_CNTPCT_LO_2_ADDR A:0x4123000
y.create.l HWIO_QDSP6SS_QTMR_V1_CNTPCT_HI_2_ADDR A:0x4123004
y.create.l HWIO_QDSP6SS_QTMR_V1_CNTVCT_LO_2_ADDR A:0x4123008
y.create.l HWIO_QDSP6SS_QTMR_V1_CNTVCT_HI_2_ADDR A:0x412300c
y.create.l HWIO_QDSP6SS_QTMR_V1_CNTFRQ_2_ADDR A:0x4123010
y.create.l HWIO_QDSP6SS_QTMR_V1_CNTPL0ACR_2_ADDR A:0x4123014
y.create.l HWIO_QDSP6SS_QTMR_V1_CNTVOFF_LO_2_ADDR A:0x4123018
y.create.l HWIO_QDSP6SS_QTMR_V1_CNTVOFF_HI_2_ADDR A:0x412301c
y.create.l HWIO_QDSP6SS_QTMR_V1_CNTP_CVAL_LO_2_ADDR A:0x4123020
y.create.l HWIO_QDSP6SS_QTMR_V1_CNTP_CVAL_HI_2_ADDR A:0x4123024
y.create.l HWIO_QDSP6SS_QTMR_V1_CNTP_TVAL_2_ADDR A:0x4123028
y.create.l HWIO_QDSP6SS_QTMR_V1_CNTP_CTL_2_ADDR A:0x412302c
y.create.l HWIO_QDSP6SS_QTMR_V1_CNTV_CVAL_LO_2_ADDR A:0x4123030
y.create.l HWIO_QDSP6SS_QTMR_V1_CNTV_CVAL_HI_2_ADDR A:0x4123034
y.create.l HWIO_QDSP6SS_QTMR_V1_CNTV_TVAL_2_ADDR A:0x4123038
y.create.l HWIO_QDSP6SS_QTMR_V1_CNTV_CTL_2_ADDR A:0x412303c
y.create.l HWIO_QDSP6SS_QTMR_V1_VERSION_2_ADDR A:0x4123fd0
y.create.l HWIO_QDSP6SS_SAW2_SECURE_ADDR A:0x4130000
y.create.l HWIO_QDSP6SS_SAW2_ID_ADDR A:0x4130004
y.create.l HWIO_QDSP6SS_SAW2_CFG_ADDR A:0x4130008
y.create.l HWIO_QDSP6SS_SAW2_SPM_STS_ADDR A:0x413000c
y.create.l HWIO_QDSP6SS_SAW2_AVS_STS_ADDR A:0x4130010
y.create.l HWIO_QDSP6SS_SAW2_PMIC_STS_ADDR A:0x4130014
y.create.l HWIO_QDSP6SS_SAW2_RST_ADDR A:0x4130018
y.create.l HWIO_QDSP6SS_SAW2_VCTL_ADDR A:0x413001c
y.create.l HWIO_QDSP6SS_SAW2_AVS_CTL_ADDR A:0x4130020
y.create.l HWIO_QDSP6SS_SAW2_AVS_LIMIT_ADDR A:0x4130024
y.create.l HWIO_QDSP6SS_SAW2_AVS_DLY_ADDR A:0x4130028
y.create.l HWIO_QDSP6SS_SAW2_AVS_HYSTERESIS_ADDR A:0x413002c
y.create.l HWIO_QDSP6SS_SAW2_SPM_CTL_ADDR A:0x4130030
y.create.l HWIO_QDSP6SS_SAW2_SPM_DLY_ADDR A:0x4130034
y.create.l HWIO_QDSP6SS_SAW2_SPM_STS2_ADDR A:0x4130038
y.create.l HWIO_QDSP6SS_SAW2_SPM_SLP_SEQ_ENTRY_0_ADDR A:0x4130400
y.create.l HWIO_QDSP6SS_SAW2_SPM_SLP_SEQ_ENTRY_1_ADDR A:0x4130404
y.create.l HWIO_QDSP6SS_SAW2_SPM_SLP_SEQ_ENTRY_2_ADDR A:0x4130408
y.create.l HWIO_QDSP6SS_SAW2_SPM_SLP_SEQ_ENTRY_3_ADDR A:0x413040c
y.create.l HWIO_QDSP6SS_SAW2_SPM_SLP_SEQ_ENTRY_4_ADDR A:0x4130410
y.create.l HWIO_QDSP6SS_SAW2_SPM_SLP_SEQ_ENTRY_5_ADDR A:0x4130414
y.create.l HWIO_QDSP6SS_SAW2_SPM_SLP_SEQ_ENTRY_6_ADDR A:0x4130418
y.create.l HWIO_QDSP6SS_SAW2_SPM_SLP_SEQ_ENTRY_7_ADDR A:0x413041c
y.create.l HWIO_QDSP6SS_SAW2_SPM_SLP_SEQ_ENTRY_8_ADDR A:0x4130420
y.create.l HWIO_QDSP6SS_SAW2_SPM_SLP_SEQ_ENTRY_9_ADDR A:0x4130424
y.create.l HWIO_QDSP6SS_SAW2_SPM_PMIC_DATA_0_ADDR A:0x4130040
y.create.l HWIO_QDSP6SS_SAW2_SPM_PMIC_DATA_1_ADDR A:0x4130044
y.create.l HWIO_QDSP6SS_SAW2_SPM_PMIC_DATA_2_ADDR A:0x4130048
y.create.l HWIO_QDSP6SS_SAW2_SPM_PMIC_DATA_3_ADDR A:0x413004c
y.create.l HWIO_QDSP6SS_SAW2_VERSION_ADDR A:0x4130fd0
y.create.l HWIO_MSS_ENABLE_ADDR A:0x4180000
y.create.l HWIO_MSS_CLAMP_MEM_ADDR A:0x4180004
y.create.l HWIO_MSS_CLAMP_IO_ADDR A:0x4180008
y.create.l HWIO_MSS_BUS_AHB2AHB_CFG_ADDR A:0x418000c
y.create.l HWIO_MSS_BUS_MAXI2AXI_CFG_ADDR A:0x4180010
y.create.l HWIO_MSS_CUSTOM_MEM_ARRSTBYN_ADDR A:0x4180014
y.create.l HWIO_MSS_ANALOG_IP_TEST_CTL_ADDR A:0x4180018
y.create.l HWIO_MSS_ATB_ID_ADDR A:0x418001c
y.create.l HWIO_MSS_DBG_BUS_CTL_ADDR A:0x4180020
y.create.l HWIO_MSS_AHB_ACCESS_ERR_IRQ_EN_ADDR A:0x4180024
y.create.l HWIO_MSS_AHB_ACCESS_ERR_IRQ_STATUS_ADDR A:0x4180028
y.create.l HWIO_MSS_AHB_ACCESS_ERR_IRQ_CLR_ADDR A:0x418002c
y.create.l HWIO_MSS_BUS_CTL_CFG_ADDR A:0x4180030
y.create.l HWIO_MSS_MSA_ADDR A:0x4180058
y.create.l HWIO_MSS_HW_VERSION_ADDR A:0x418005c
y.create.l HWIO_MSS_MODEM_MEM_SLP_CNTL_ADDR A:0x4180060
y.create.l HWIO_MSS_CLOCK_SPDM_MON_ADDR A:0x4180064
y.create.l HWIO_MSS_BBRX0_MUX_SEL_ADDR A:0x4180068
y.create.l HWIO_MSS_BBRX1_MUX_SEL_ADDR A:0x418006c
y.create.l HWIO_MSS_DEBUG_CLOCK_CTL_ADDR A:0x4180078
y.create.l HWIO_MSS_BBRX_EXT_CLOCK_MUX_SEL_ADDR A:0x418007c
y.create.l HWIO_MSS_BBRX_CTL_ADDR A:0x4180094
y.create.l HWIO_MSS_DEBUG_CTL_ADDR A:0x4180098
y.create.l HWIO_MSS_POWER_ADDR A:0x418009c
y.create.l HWIO_MSS_MSA_NC_HM_ADDR A:0x41800a0
y.create.l HWIO_MSS_CXM_ADDR A:0x41800a4
y.create.l HWIO_MSS_RELAY_MSG_SHADOW_00_ADDR A:0x4180400
y.create.l HWIO_MSS_RELAY_MSG_SHADOW_01_ADDR A:0x4180404
y.create.l HWIO_MSS_RELAY_MSG_SHADOW_02_ADDR A:0x4180408
y.create.l HWIO_MSS_RELAY_MSG_SHADOW_03_ADDR A:0x418040c
y.create.l HWIO_MSS_RELAY_MSG_SHADOW_04_ADDR A:0x4180410
y.create.l HWIO_MSS_RELAY_MSG_SHADOW_05_ADDR A:0x4180414
y.create.l HWIO_MSS_RELAY_MSG_SHADOW_06_ADDR A:0x4180418
y.create.l HWIO_MSS_RELAY_MSG_SHADOW_07_ADDR A:0x418041c
y.create.l HWIO_MSS_RELAY_MSG_SHADOW_08_ADDR A:0x4180420
y.create.l HWIO_MSS_RELAY_MSG_SHADOW_09_ADDR A:0x4180424
y.create.l HWIO_MSS_RELAY_MSG_SHADOW_10_ADDR A:0x4180428
y.create.l HWIO_MSS_RELAY_MSG_SHADOW_11_ADDR A:0x418042c
y.create.l HWIO_MSS_RELAY_MSG_SHADOW_12_ADDR A:0x4180430
y.create.l HWIO_MSS_RELAY_MSG_SHADOW_13_ADDR A:0x4180434
y.create.l HWIO_MSS_RELAY_MSG_SHADOW_14_ADDR A:0x4180438
y.create.l HWIO_MSS_RELAY_MSG_SHADOW_15_ADDR A:0x418043c
y.create.l HWIO_MSS_MPLL1_MODE_ADDR A:0x4181020
y.create.l HWIO_MSS_MPLL1_L_VAL_ADDR A:0x4181024
y.create.l HWIO_MSS_MPLL1_M_VAL_ADDR A:0x4181028
y.create.l HWIO_MSS_MPLL1_N_VAL_ADDR A:0x418102c
y.create.l HWIO_MSS_MPLL1_USER_CTL_ADDR A:0x4181030
y.create.l HWIO_MSS_MPLL1_CONFIG_CTL_ADDR A:0x4181034
y.create.l HWIO_MSS_MPLL1_TEST_CTL_ADDR A:0x4181038
y.create.l HWIO_MSS_MPLL1_STATUS_ADDR A:0x418103c
y.create.l HWIO_MSS_UIM0_BCR_ADDR A:0x4181060
y.create.l HWIO_MSS_UIM1_BCR_ADDR A:0x4181064
y.create.l HWIO_MSS_Q6SS_BCR_ADDR A:0x4181068
y.create.l HWIO_MSS_NAV_CE_BRIDGE_BCR_ADDR A:0x418106c
y.create.l HWIO_MSS_CRYPTO_BCR_ADDR A:0x4181070
y.create.l HWIO_MSS_NAV_BCR_ADDR A:0x4181074
y.create.l HWIO_MSS_UIM0_CBCR_ADDR A:0x4181078
y.create.l HWIO_MSS_UIM1_CBCR_ADDR A:0x418107c
y.create.l HWIO_MSS_XO_UIM0_CBCR_ADDR A:0x4181080
y.create.l HWIO_MSS_XO_UIM1_CBCR_ADDR A:0x4181084
y.create.l HWIO_MSS_XO_MODEM_CBCR_ADDR A:0x4181088
y.create.l HWIO_MSS_BUS_UIM0_CBCR_ADDR A:0x4181090
y.create.l HWIO_MSS_BUS_UIM1_CBCR_ADDR A:0x4181094
y.create.l HWIO_MSS_BUS_CSR_CBCR_ADDR A:0x4181098
y.create.l HWIO_MSS_BUS_BRIDGE_CBCR_ADDR A:0x418109c
y.create.l HWIO_MSS_BUS_MODEM_CBCR_ADDR A:0x41810a0
y.create.l HWIO_MSS_BUS_Q6_CBCR_ADDR A:0x41810a4
y.create.l HWIO_MSS_BUS_NAV_CE_BRIDGE_CBCR_ADDR A:0x41810a8
y.create.l HWIO_MSS_BUS_CRYPTO_CBCR_ADDR A:0x41810ac
y.create.l HWIO_MSS_BUS_NAV_CBCR_ADDR A:0x41810b0
y.create.l HWIO_MSS_BUS_ATB_CBCR_ADDR A:0x41810b8
y.create.l HWIO_MSS_BUS_MODEM_BRIDGE_CX_CBCR_ADDR A:0x41810c0
y.create.l HWIO_MSS_BUS_SLAVE_TIMEOUT_CBCR_ADDR A:0x41810c4
y.create.l HWIO_MSS_BUS_COMBODAC_COMP_CBCR_ADDR A:0x41810cc
y.create.l HWIO_MSS_MODEM_CFG_AHB_CBCR_ADDR A:0x41810d4
y.create.l HWIO_MSS_MODEM_SNOC_AXI_CBCR_ADDR A:0x41810d8
y.create.l HWIO_MSS_NAV_SNOC_AXI_CBCR_ADDR A:0x41810dc
y.create.l HWIO_MSS_MPLL2_MAIN_BUS_CBCR_ADDR A:0x41810e0
y.create.l HWIO_MSS_MPLL1_MAIN_CBCR_ADDR A:0x41810e8
y.create.l HWIO_MSS_MPLL1_MAIN_BUS_CBCR_ADDR A:0x41810ec
y.create.l HWIO_MSS_MPLL1_EARLY_DIV5_CBCR_ADDR A:0x41810f0
y.create.l HWIO_MSS_MPLL1_EARLY_DIV3_CBCR_ADDR A:0x41810f4
y.create.l HWIO_MSS_MPLL1_OUT_EARLY_DIV3_CBCR_ADDR A:0x4181100
y.create.l HWIO_MSS_MPLL1_OUT_EARLY_DIV5_CBCR_ADDR A:0x4181104
y.create.l HWIO_MSS_BUS_CMD_RCGR_ADDR A:0x4181108
y.create.l HWIO_MSS_BUS_CFG_RCGR_ADDR A:0x418110c
y.create.l HWIO_MSS_Q6_CMD_RCGR_ADDR A:0x4181110
y.create.l HWIO_MSS_Q6_CFG_RCGR_ADDR A:0x4181114
y.create.l HWIO_MSS_UIM_CMD_RCGR_ADDR A:0x4181118
y.create.l HWIO_MSS_UIM_CFG_RCGR_ADDR A:0x418111c
y.create.l HWIO_MSS_BBRX0_CBCR_ADDR A:0x4181120
y.create.l HWIO_MSS_BBRX1_CBCR_ADDR A:0x4181124
y.create.l HWIO_MSS_BIMC_THROTTLE_ADDR A:0x4181130
y.create.l HWIO_MSS_RESERVE_02_ADDR A:0x4181134
y.create.l HWIO_MSS_BBRX0_MISC_ADDR A:0x4181138
y.create.l HWIO_MSS_BBRX1_MISC_ADDR A:0x418113c
y.create.l HWIO_MSS_UIM0_MND_CMD_RCGR_ADDR A:0x4181150
y.create.l HWIO_MSS_UIM0_MND_CFG_RCGR_ADDR A:0x4181154
y.create.l HWIO_MSS_UIM0_MND_M_ADDR A:0x4181158
y.create.l HWIO_MSS_UIM0_MND_N_ADDR A:0x418115c
y.create.l HWIO_MSS_UIM0_MND_D_ADDR A:0x4181160
y.create.l HWIO_MSS_UIM1_MND_CMD_RCGR_ADDR A:0x4181164
y.create.l HWIO_MSS_UIM1_MND_CFG_RCGR_ADDR A:0x4181168
y.create.l HWIO_MSS_UIM1_MND_M_ADDR A:0x418116c
y.create.l HWIO_MSS_UIM1_MND_N_ADDR A:0x4181170
y.create.l HWIO_MSS_UIM1_MND_D_ADDR A:0x4181174
y.create.l HWIO_MSS_BUS_MGPI_CBCR_ADDR A:0x418119c
y.create.l HWIO_MSS_MGPI_BCR_ADDR A:0x41811a0
y.create.l HWIO_MSS_BIT_COXM_MND_CMD_RCGR_ADDR A:0x4181214
y.create.l HWIO_MSS_BIT_COXM_MND_CFG_RCGR_ADDR A:0x4181218
y.create.l HWIO_MSS_BIT_COXM_MND_M_ADDR A:0x418121c
y.create.l HWIO_MSS_BIT_COXM_MND_N_ADDR A:0x4181220
y.create.l HWIO_MSS_BIT_COXM_MND_D_ADDR A:0x4181224
y.create.l HWIO_MSS_BIT_COXM_CBCR_ADDR A:0x418122c
y.create.l HWIO_MSS_BUS_COXM_CBCR_ADDR A:0x4181230
y.create.l HWIO_MSS_COXM_BCR_ADDR A:0x4181234
y.create.l HWIO_MSS_TCSR_ACC_SEL_ADDR A:0x418f000
y.create.l HWIO_MSS_UIM0_UART_DM_MR1_ADDR A:0x4190000
y.create.l HWIO_MSS_UIM0_UART_DM_MR2_ADDR A:0x4190004
y.create.l HWIO_MSS_UIM0_UART_DM_CSR_SR_DEPRECATED_ADDR A:0x4190008
y.create.l HWIO_MSS_UIM0_UART_DM_CR_MISR_DEPRECATED_ADDR A:0x4190010
y.create.l HWIO_MSS_UIM0_UART_DM_IMR_ISR_DEPRECATED_ADDR A:0x4190014
y.create.l HWIO_MSS_UIM0_UART_DM_IPR_ADDR A:0x4190018
y.create.l HWIO_MSS_UIM0_UART_DM_TFWR_ADDR A:0x419001c
y.create.l HWIO_MSS_UIM0_UART_DM_RFWR_ADDR A:0x4190020
y.create.l HWIO_MSS_UIM0_UART_DM_HCR_ADDR A:0x4190024
y.create.l HWIO_MSS_UIM0_UART_DM_DMRX_ADDR A:0x4190034
y.create.l HWIO_MSS_UIM0_UART_DM_IRDA_RX_TOTAL_SNAP_DEPRECATED_ADDR A:0x4190038
y.create.l HWIO_MSS_UIM0_UART_DM_DMEN_ADDR A:0x419003c
y.create.l HWIO_MSS_UIM0_UART_DM_NO_CHARS_FOR_TX_ADDR A:0x4190040
y.create.l HWIO_MSS_UIM0_UART_DM_BADR_ADDR A:0x4190044
y.create.l HWIO_MSS_UIM0_UART_DM_TESTSL_ADDR A:0x4190048
y.create.l HWIO_MSS_UIM0_UART_DM_TXFS_ADDR A:0x419004c
y.create.l HWIO_MSS_UIM0_UART_DM_RXFS_ADDR A:0x4190050
y.create.l HWIO_MSS_UIM0_UART_DM_MISR_MODE_ADDR A:0x4190060
y.create.l HWIO_MSS_UIM0_UART_DM_MISR_RESET_ADDR A:0x4190064
y.create.l HWIO_MSS_UIM0_UART_DM_MISR_EXPORT_ADDR A:0x4190068
y.create.l HWIO_MSS_UIM0_UART_DM_MISR_VAL_ADDR A:0x419006c
y.create.l HWIO_MSS_UIM0_UART_DM_TF_RF_DEPRECATED_ADDR A:0x4190070
y.create.l HWIO_MSS_UIM0_UART_DM_TF_RF_2_DEPRECATED_ADDR A:0x4190074
y.create.l HWIO_MSS_UIM0_UART_DM_TF_RF_3_DEPRECATED_ADDR A:0x4190078
y.create.l HWIO_MSS_UIM0_UART_DM_TF_RF_4_DEPRECATED_ADDR A:0x419007c
y.create.l HWIO_MSS_UIM0_UART_DM_SIM_CFG_ADDR A:0x4190080
y.create.l HWIO_MSS_UIM0_UART_DM_TEST_WR_ADDR_ADDR A:0x4190084
y.create.l HWIO_MSS_UIM0_UART_DM_TEST_WR_DATA_ADDR A:0x4190088
y.create.l HWIO_MSS_UIM0_UART_DM_TEST_RD_ADDR_ADDR A:0x419008c
y.create.l HWIO_MSS_UIM0_UART_DM_TEST_RD_DATA_ADDR A:0x4190090
y.create.l HWIO_MSS_UIM0_UART_DM_CSR_ADDR A:0x41900a0
y.create.l HWIO_MSS_UIM0_UART_DM_SR_ADDR A:0x41900a4
y.create.l HWIO_MSS_UIM0_UART_DM_CR_ADDR A:0x41900a8
y.create.l HWIO_MSS_UIM0_UART_DM_MISR_ADDR A:0x41900ac
y.create.l HWIO_MSS_UIM0_UART_DM_IMR_ADDR A:0x41900b0
y.create.l HWIO_MSS_UIM0_UART_DM_ISR_ADDR A:0x41900b4
y.create.l HWIO_MSS_UIM0_UART_DM_IRDA_ADDR A:0x41900b8
y.create.l HWIO_MSS_UIM0_UART_DM_RX_TOTAL_SNAP_ADDR A:0x41900bc
y.create.l HWIO_MSS_UIM0_UART_DM_WWT_TIMEOUT_ADDR A:0x41900c0
y.create.l HWIO_MSS_UIM0_UART_DM_CLK_CTRL_ADDR A:0x41900c4
y.create.l HWIO_MSS_UIM0_UART_DM_BCR_ADDR A:0x41900c8
y.create.l HWIO_MSS_UIM0_UART_DM_RX_TRANS_CTRL_ADDR A:0x41900cc
y.create.l HWIO_MSS_UIM0_UART_DM_DMRX_DBG_ADDR A:0x41900d0
y.create.l HWIO_MSS_UIM0_UART_DM_FSM_STATUS_ADDR A:0x41900d4
y.create.l HWIO_MSS_UIM0_UART_DM_HW_VERSION_ADDR A:0x41900d8
y.create.l HWIO_MSS_UIM0_UART_DM_GENERICS_ADDR A:0x41900dc
y.create.l HWIO_MSS_UIM0_UART_DM_ISR_CLR_ADDR A:0x41900e0
y.create.l HWIO_MSS_UIM0_UART_DM_TF_ADDR A:0x4190100
y.create.l HWIO_MSS_UIM0_UART_DM_TF_2_ADDR A:0x4190104
y.create.l HWIO_MSS_UIM0_UART_DM_TF_3_ADDR A:0x4190108
y.create.l HWIO_MSS_UIM0_UART_DM_TF_4_ADDR A:0x419010c
y.create.l HWIO_MSS_UIM0_UART_DM_TF_5_ADDR A:0x4190110
y.create.l HWIO_MSS_UIM0_UART_DM_TF_6_ADDR A:0x4190114
y.create.l HWIO_MSS_UIM0_UART_DM_TF_7_ADDR A:0x4190118
y.create.l HWIO_MSS_UIM0_UART_DM_TF_8_ADDR A:0x419011c
y.create.l HWIO_MSS_UIM0_UART_DM_TF_9_ADDR A:0x4190120
y.create.l HWIO_MSS_UIM0_UART_DM_TF_10_ADDR A:0x4190124
y.create.l HWIO_MSS_UIM0_UART_DM_TF_11_ADDR A:0x4190128
y.create.l HWIO_MSS_UIM0_UART_DM_TF_12_ADDR A:0x419012c
y.create.l HWIO_MSS_UIM0_UART_DM_TF_13_ADDR A:0x4190130
y.create.l HWIO_MSS_UIM0_UART_DM_TF_14_ADDR A:0x4190134
y.create.l HWIO_MSS_UIM0_UART_DM_TF_15_ADDR A:0x4190138
y.create.l HWIO_MSS_UIM0_UART_DM_TF_16_ADDR A:0x419013c
y.create.l HWIO_MSS_UIM0_UART_DM_RF_ADDR A:0x4190140
y.create.l HWIO_MSS_UIM0_UART_DM_RF_2_ADDR A:0x4190144
y.create.l HWIO_MSS_UIM0_UART_DM_RF_3_ADDR A:0x4190148
y.create.l HWIO_MSS_UIM0_UART_DM_RF_4_ADDR A:0x419014c
y.create.l HWIO_MSS_UIM0_UART_DM_RF_5_ADDR A:0x4190150
y.create.l HWIO_MSS_UIM0_UART_DM_RF_6_ADDR A:0x4190154
y.create.l HWIO_MSS_UIM0_UART_DM_RF_7_ADDR A:0x4190158
y.create.l HWIO_MSS_UIM0_UART_DM_RF_8_ADDR A:0x419015c
y.create.l HWIO_MSS_UIM0_UART_DM_RF_9_ADDR A:0x4190160
y.create.l HWIO_MSS_UIM0_UART_DM_RF_10_ADDR A:0x4190164
y.create.l HWIO_MSS_UIM0_UART_DM_RF_11_ADDR A:0x4190168
y.create.l HWIO_MSS_UIM0_UART_DM_RF_12_ADDR A:0x419016c
y.create.l HWIO_MSS_UIM0_UART_DM_RF_13_ADDR A:0x4190170
y.create.l HWIO_MSS_UIM0_UART_DM_RF_14_ADDR A:0x4190174
y.create.l HWIO_MSS_UIM0_UART_DM_RF_15_ADDR A:0x4190178
y.create.l HWIO_MSS_UIM0_UART_DM_RF_16_ADDR A:0x419017c
y.create.l HWIO_MSS_UIM0_UART_DM_UIM_CFG_ADDR A:0x4190180
y.create.l HWIO_MSS_UIM0_UART_DM_UIM_CMD_ADDR A:0x4190184
y.create.l HWIO_MSS_UIM0_UART_DM_UIM_IO_STATUS_ADDR A:0x4190188
y.create.l HWIO_MSS_UIM0_UART_DM_UIM_IRQ_ISR_ADDR A:0x419018c
y.create.l HWIO_MSS_UIM0_UART_DM_UIM_IRQ_MISR_ADDR A:0x4190190
y.create.l HWIO_MSS_UIM0_UART_DM_UIM_IRQ_CLR_ADDR A:0x4190194
y.create.l HWIO_MSS_UIM0_UART_DM_UIM_IRQ_IMR_ADDR A:0x4190198
y.create.l HWIO_MSS_UIM0_UART_DM_UIM_IRQ_IMR_SET_ADDR A:0x419019c
y.create.l HWIO_MSS_UIM0_UART_DM_UIM_IRQ_IMR_CLR_ADDR A:0x41901a0
y.create.l HWIO_MSS_UIM1_UART_DM_MR1_ADDR A:0x4198000
y.create.l HWIO_MSS_UIM1_UART_DM_MR2_ADDR A:0x4198004
y.create.l HWIO_MSS_UIM1_UART_DM_CSR_SR_DEPRECATED_ADDR A:0x4198008
y.create.l HWIO_MSS_UIM1_UART_DM_CR_MISR_DEPRECATED_ADDR A:0x4198010
y.create.l HWIO_MSS_UIM1_UART_DM_IMR_ISR_DEPRECATED_ADDR A:0x4198014
y.create.l HWIO_MSS_UIM1_UART_DM_IPR_ADDR A:0x4198018
y.create.l HWIO_MSS_UIM1_UART_DM_TFWR_ADDR A:0x419801c
y.create.l HWIO_MSS_UIM1_UART_DM_RFWR_ADDR A:0x4198020
y.create.l HWIO_MSS_UIM1_UART_DM_HCR_ADDR A:0x4198024
y.create.l HWIO_MSS_UIM1_UART_DM_DMRX_ADDR A:0x4198034
y.create.l HWIO_MSS_UIM1_UART_DM_IRDA_RX_TOTAL_SNAP_DEPRECATED_ADDR A:0x4198038
y.create.l HWIO_MSS_UIM1_UART_DM_DMEN_ADDR A:0x419803c
y.create.l HWIO_MSS_UIM1_UART_DM_NO_CHARS_FOR_TX_ADDR A:0x4198040
y.create.l HWIO_MSS_UIM1_UART_DM_BADR_ADDR A:0x4198044
y.create.l HWIO_MSS_UIM1_UART_DM_TESTSL_ADDR A:0x4198048
y.create.l HWIO_MSS_UIM1_UART_DM_TXFS_ADDR A:0x419804c
y.create.l HWIO_MSS_UIM1_UART_DM_RXFS_ADDR A:0x4198050
y.create.l HWIO_MSS_UIM1_UART_DM_MISR_MODE_ADDR A:0x4198060
y.create.l HWIO_MSS_UIM1_UART_DM_MISR_RESET_ADDR A:0x4198064
y.create.l HWIO_MSS_UIM1_UART_DM_MISR_EXPORT_ADDR A:0x4198068
y.create.l HWIO_MSS_UIM1_UART_DM_MISR_VAL_ADDR A:0x419806c
y.create.l HWIO_MSS_UIM1_UART_DM_TF_RF_DEPRECATED_ADDR A:0x4198070
y.create.l HWIO_MSS_UIM1_UART_DM_TF_RF_2_DEPRECATED_ADDR A:0x4198074
y.create.l HWIO_MSS_UIM1_UART_DM_TF_RF_3_DEPRECATED_ADDR A:0x4198078
y.create.l HWIO_MSS_UIM1_UART_DM_TF_RF_4_DEPRECATED_ADDR A:0x419807c
y.create.l HWIO_MSS_UIM1_UART_DM_SIM_CFG_ADDR A:0x4198080
y.create.l HWIO_MSS_UIM1_UART_DM_TEST_WR_ADDR_ADDR A:0x4198084
y.create.l HWIO_MSS_UIM1_UART_DM_TEST_WR_DATA_ADDR A:0x4198088
y.create.l HWIO_MSS_UIM1_UART_DM_TEST_RD_ADDR_ADDR A:0x419808c
y.create.l HWIO_MSS_UIM1_UART_DM_TEST_RD_DATA_ADDR A:0x4198090
y.create.l HWIO_MSS_UIM1_UART_DM_CSR_ADDR A:0x41980a0
y.create.l HWIO_MSS_UIM1_UART_DM_SR_ADDR A:0x41980a4
y.create.l HWIO_MSS_UIM1_UART_DM_CR_ADDR A:0x41980a8
y.create.l HWIO_MSS_UIM1_UART_DM_MISR_ADDR A:0x41980ac
y.create.l HWIO_MSS_UIM1_UART_DM_IMR_ADDR A:0x41980b0
y.create.l HWIO_MSS_UIM1_UART_DM_ISR_ADDR A:0x41980b4
y.create.l HWIO_MSS_UIM1_UART_DM_IRDA_ADDR A:0x41980b8
y.create.l HWIO_MSS_UIM1_UART_DM_RX_TOTAL_SNAP_ADDR A:0x41980bc
y.create.l HWIO_MSS_UIM1_UART_DM_WWT_TIMEOUT_ADDR A:0x41980c0
y.create.l HWIO_MSS_UIM1_UART_DM_CLK_CTRL_ADDR A:0x41980c4
y.create.l HWIO_MSS_UIM1_UART_DM_BCR_ADDR A:0x41980c8
y.create.l HWIO_MSS_UIM1_UART_DM_RX_TRANS_CTRL_ADDR A:0x41980cc
y.create.l HWIO_MSS_UIM1_UART_DM_DMRX_DBG_ADDR A:0x41980d0
y.create.l HWIO_MSS_UIM1_UART_DM_FSM_STATUS_ADDR A:0x41980d4
y.create.l HWIO_MSS_UIM1_UART_DM_HW_VERSION_ADDR A:0x41980d8
y.create.l HWIO_MSS_UIM1_UART_DM_GENERICS_ADDR A:0x41980dc
y.create.l HWIO_MSS_UIM1_UART_DM_ISR_CLR_ADDR A:0x41980e0
y.create.l HWIO_MSS_UIM1_UART_DM_TF_ADDR A:0x4198100
y.create.l HWIO_MSS_UIM1_UART_DM_TF_2_ADDR A:0x4198104
y.create.l HWIO_MSS_UIM1_UART_DM_TF_3_ADDR A:0x4198108
y.create.l HWIO_MSS_UIM1_UART_DM_TF_4_ADDR A:0x419810c
y.create.l HWIO_MSS_UIM1_UART_DM_TF_5_ADDR A:0x4198110
y.create.l HWIO_MSS_UIM1_UART_DM_TF_6_ADDR A:0x4198114
y.create.l HWIO_MSS_UIM1_UART_DM_TF_7_ADDR A:0x4198118
y.create.l HWIO_MSS_UIM1_UART_DM_TF_8_ADDR A:0x419811c
y.create.l HWIO_MSS_UIM1_UART_DM_TF_9_ADDR A:0x4198120
y.create.l HWIO_MSS_UIM1_UART_DM_TF_10_ADDR A:0x4198124
y.create.l HWIO_MSS_UIM1_UART_DM_TF_11_ADDR A:0x4198128
y.create.l HWIO_MSS_UIM1_UART_DM_TF_12_ADDR A:0x419812c
y.create.l HWIO_MSS_UIM1_UART_DM_TF_13_ADDR A:0x4198130
y.create.l HWIO_MSS_UIM1_UART_DM_TF_14_ADDR A:0x4198134
y.create.l HWIO_MSS_UIM1_UART_DM_TF_15_ADDR A:0x4198138
y.create.l HWIO_MSS_UIM1_UART_DM_TF_16_ADDR A:0x419813c
y.create.l HWIO_MSS_UIM1_UART_DM_RF_ADDR A:0x4198140
y.create.l HWIO_MSS_UIM1_UART_DM_RF_2_ADDR A:0x4198144
y.create.l HWIO_MSS_UIM1_UART_DM_RF_3_ADDR A:0x4198148
y.create.l HWIO_MSS_UIM1_UART_DM_RF_4_ADDR A:0x419814c
y.create.l HWIO_MSS_UIM1_UART_DM_RF_5_ADDR A:0x4198150
y.create.l HWIO_MSS_UIM1_UART_DM_RF_6_ADDR A:0x4198154
y.create.l HWIO_MSS_UIM1_UART_DM_RF_7_ADDR A:0x4198158
y.create.l HWIO_MSS_UIM1_UART_DM_RF_8_ADDR A:0x419815c
y.create.l HWIO_MSS_UIM1_UART_DM_RF_9_ADDR A:0x4198160
y.create.l HWIO_MSS_UIM1_UART_DM_RF_10_ADDR A:0x4198164
y.create.l HWIO_MSS_UIM1_UART_DM_RF_11_ADDR A:0x4198168
y.create.l HWIO_MSS_UIM1_UART_DM_RF_12_ADDR A:0x419816c
y.create.l HWIO_MSS_UIM1_UART_DM_RF_13_ADDR A:0x4198170
y.create.l HWIO_MSS_UIM1_UART_DM_RF_14_ADDR A:0x4198174
y.create.l HWIO_MSS_UIM1_UART_DM_RF_15_ADDR A:0x4198178
y.create.l HWIO_MSS_UIM1_UART_DM_RF_16_ADDR A:0x419817c
y.create.l HWIO_MSS_UIM1_UART_DM_UIM_CFG_ADDR A:0x4198180
y.create.l HWIO_MSS_UIM1_UART_DM_UIM_CMD_ADDR A:0x4198184
y.create.l HWIO_MSS_UIM1_UART_DM_UIM_IO_STATUS_ADDR A:0x4198188
y.create.l HWIO_MSS_UIM1_UART_DM_UIM_IRQ_ISR_ADDR A:0x419818c
y.create.l HWIO_MSS_UIM1_UART_DM_UIM_IRQ_MISR_ADDR A:0x4198190
y.create.l HWIO_MSS_UIM1_UART_DM_UIM_IRQ_CLR_ADDR A:0x4198194
y.create.l HWIO_MSS_UIM1_UART_DM_UIM_IRQ_IMR_ADDR A:0x4198198
y.create.l HWIO_MSS_UIM1_UART_DM_UIM_IRQ_IMR_SET_ADDR A:0x419819c
y.create.l HWIO_MSS_UIM1_UART_DM_UIM_IRQ_IMR_CLR_ADDR A:0x41981a0
y.create.l HWIO_MSS_CXM_UART_DM_MR1_ADDR A:0x41a0000
y.create.l HWIO_MSS_CXM_UART_DM_MR2_ADDR A:0x41a0004
y.create.l HWIO_MSS_CXM_UART_DM_CSR_SR_DEPRECATED_ADDR A:0x41a0008
y.create.l HWIO_MSS_CXM_UART_DM_CR_MISR_DEPRECATED_ADDR A:0x41a0010
y.create.l HWIO_MSS_CXM_UART_DM_IMR_ISR_DEPRECATED_ADDR A:0x41a0014
y.create.l HWIO_MSS_CXM_UART_DM_IPR_ADDR A:0x41a0018
y.create.l HWIO_MSS_CXM_UART_DM_TFWR_ADDR A:0x41a001c
y.create.l HWIO_MSS_CXM_UART_DM_RFWR_ADDR A:0x41a0020
y.create.l HWIO_MSS_CXM_UART_DM_HCR_ADDR A:0x41a0024
y.create.l HWIO_MSS_CXM_UART_DM_DMRX_ADDR A:0x41a0034
y.create.l HWIO_MSS_CXM_UART_DM_IRDA_RX_TOTAL_SNAP_DEPRECATED_ADDR A:0x41a0038
y.create.l HWIO_MSS_CXM_UART_DM_DMEN_ADDR A:0x41a003c
y.create.l HWIO_MSS_CXM_UART_DM_NO_CHARS_FOR_TX_ADDR A:0x41a0040
y.create.l HWIO_MSS_CXM_UART_DM_BADR_ADDR A:0x41a0044
y.create.l HWIO_MSS_CXM_UART_DM_TESTSL_ADDR A:0x41a0048
y.create.l HWIO_MSS_CXM_UART_DM_TXFS_ADDR A:0x41a004c
y.create.l HWIO_MSS_CXM_UART_DM_RXFS_ADDR A:0x41a0050
y.create.l HWIO_MSS_CXM_UART_DM_MISR_MODE_ADDR A:0x41a0060
y.create.l HWIO_MSS_CXM_UART_DM_MISR_RESET_ADDR A:0x41a0064
y.create.l HWIO_MSS_CXM_UART_DM_MISR_EXPORT_ADDR A:0x41a0068
y.create.l HWIO_MSS_CXM_UART_DM_MISR_VAL_ADDR A:0x41a006c
y.create.l HWIO_MSS_CXM_UART_DM_TF_RF_DEPRECATED_ADDR A:0x41a0070
y.create.l HWIO_MSS_CXM_UART_DM_TF_RF_2_DEPRECATED_ADDR A:0x41a0074
y.create.l HWIO_MSS_CXM_UART_DM_TF_RF_3_DEPRECATED_ADDR A:0x41a0078
y.create.l HWIO_MSS_CXM_UART_DM_TF_RF_4_DEPRECATED_ADDR A:0x41a007c
y.create.l HWIO_MSS_CXM_UART_DM_SIM_CFG_ADDR A:0x41a0080
y.create.l HWIO_MSS_CXM_UART_DM_TEST_WR_ADDR_ADDR A:0x41a0084
y.create.l HWIO_MSS_CXM_UART_DM_TEST_WR_DATA_ADDR A:0x41a0088
y.create.l HWIO_MSS_CXM_UART_DM_TEST_RD_ADDR_ADDR A:0x41a008c
y.create.l HWIO_MSS_CXM_UART_DM_TEST_RD_DATA_ADDR A:0x41a0090
y.create.l HWIO_MSS_CXM_UART_DM_CSR_ADDR A:0x41a00a0
y.create.l HWIO_MSS_CXM_UART_DM_SR_ADDR A:0x41a00a4
y.create.l HWIO_MSS_CXM_UART_DM_CR_ADDR A:0x41a00a8
y.create.l HWIO_MSS_CXM_UART_DM_MISR_ADDR A:0x41a00ac
y.create.l HWIO_MSS_CXM_UART_DM_IMR_ADDR A:0x41a00b0
y.create.l HWIO_MSS_CXM_UART_DM_ISR_ADDR A:0x41a00b4
y.create.l HWIO_MSS_CXM_UART_DM_IRDA_ADDR A:0x41a00b8
y.create.l HWIO_MSS_CXM_UART_DM_RX_TOTAL_SNAP_ADDR A:0x41a00bc
y.create.l HWIO_MSS_CXM_UART_DM_WWT_TIMEOUT_ADDR A:0x41a00c0
y.create.l HWIO_MSS_CXM_UART_DM_CLK_CTRL_ADDR A:0x41a00c4
y.create.l HWIO_MSS_CXM_UART_DM_BCR_ADDR A:0x41a00c8
y.create.l HWIO_MSS_CXM_UART_DM_RX_TRANS_CTRL_ADDR A:0x41a00cc
y.create.l HWIO_MSS_CXM_UART_DM_DMRX_DBG_ADDR A:0x41a00d0
y.create.l HWIO_MSS_CXM_UART_DM_FSM_STATUS_ADDR A:0x41a00d4
y.create.l HWIO_MSS_CXM_UART_DM_HW_VERSION_ADDR A:0x41a00d8
y.create.l HWIO_MSS_CXM_UART_DM_GENERICS_ADDR A:0x41a00dc
y.create.l HWIO_MSS_CXM_UART_DM_TF_ADDR A:0x41a0100
y.create.l HWIO_MSS_CXM_UART_DM_TF_2_ADDR A:0x41a0104
y.create.l HWIO_MSS_CXM_UART_DM_TF_3_ADDR A:0x41a0108
y.create.l HWIO_MSS_CXM_UART_DM_TF_4_ADDR A:0x41a010c
y.create.l HWIO_MSS_CXM_UART_DM_TF_5_ADDR A:0x41a0110
y.create.l HWIO_MSS_CXM_UART_DM_TF_6_ADDR A:0x41a0114
y.create.l HWIO_MSS_CXM_UART_DM_TF_7_ADDR A:0x41a0118
y.create.l HWIO_MSS_CXM_UART_DM_TF_8_ADDR A:0x41a011c
y.create.l HWIO_MSS_CXM_UART_DM_TF_9_ADDR A:0x41a0120
y.create.l HWIO_MSS_CXM_UART_DM_TF_10_ADDR A:0x41a0124
y.create.l HWIO_MSS_CXM_UART_DM_TF_11_ADDR A:0x41a0128
y.create.l HWIO_MSS_CXM_UART_DM_TF_12_ADDR A:0x41a012c
y.create.l HWIO_MSS_CXM_UART_DM_TF_13_ADDR A:0x41a0130
y.create.l HWIO_MSS_CXM_UART_DM_TF_14_ADDR A:0x41a0134
y.create.l HWIO_MSS_CXM_UART_DM_TF_15_ADDR A:0x41a0138
y.create.l HWIO_MSS_CXM_UART_DM_TF_16_ADDR A:0x41a013c
y.create.l HWIO_MSS_CXM_UART_DM_RF_ADDR A:0x41a0140
y.create.l HWIO_MSS_CXM_UART_DM_RF_2_ADDR A:0x41a0144
y.create.l HWIO_MSS_CXM_UART_DM_RF_3_ADDR A:0x41a0148
y.create.l HWIO_MSS_CXM_UART_DM_RF_4_ADDR A:0x41a014c
y.create.l HWIO_MSS_CXM_UART_DM_RF_5_ADDR A:0x41a0150
y.create.l HWIO_MSS_CXM_UART_DM_RF_6_ADDR A:0x41a0154
y.create.l HWIO_MSS_CXM_UART_DM_RF_7_ADDR A:0x41a0158
y.create.l HWIO_MSS_CXM_UART_DM_RF_8_ADDR A:0x41a015c
y.create.l HWIO_MSS_CXM_UART_DM_RF_9_ADDR A:0x41a0160
y.create.l HWIO_MSS_CXM_UART_DM_RF_10_ADDR A:0x41a0164
y.create.l HWIO_MSS_CXM_UART_DM_RF_11_ADDR A:0x41a0168
y.create.l HWIO_MSS_CXM_UART_DM_RF_12_ADDR A:0x41a016c
y.create.l HWIO_MSS_CXM_UART_DM_RF_13_ADDR A:0x41a0170
y.create.l HWIO_MSS_CXM_UART_DM_RF_14_ADDR A:0x41a0174
y.create.l HWIO_MSS_CXM_UART_DM_RF_15_ADDR A:0x41a0178
y.create.l HWIO_MSS_CXM_UART_DM_RF_16_ADDR A:0x41a017c
y.create.l HWIO_MSS_CXM_UART_DM_UIM_CFG_ADDR A:0x41a0180
y.create.l HWIO_MSS_CXM_UART_DM_UIM_CMD_ADDR A:0x41a0184
y.create.l HWIO_MSS_CXM_UART_DM_UIM_IO_STATUS_ADDR A:0x41a0188
y.create.l HWIO_MSS_CXM_UART_DM_UIM_IRQ_ISR_ADDR A:0x41a018c
y.create.l HWIO_MSS_CXM_UART_DM_UIM_IRQ_MISR_ADDR A:0x41a0190
y.create.l HWIO_MSS_CXM_UART_DM_UIM_IRQ_CLR_ADDR A:0x41a0194
y.create.l HWIO_MSS_CXM_UART_DM_UIM_IRQ_IMR_ADDR A:0x41a0198
y.create.l HWIO_MSS_CXM_UART_DM_UIM_IRQ_IMR_SET_ADDR A:0x41a019c
y.create.l HWIO_MSS_CXM_UART_DM_UIM_IRQ_IMR_CLR_ADDR A:0x41a01a0
y.create.l HWIO_MSS_CXM_CONFIG_ADDR A:0x41a01a4
y.create.l HWIO_MSS_CXM_TX_CONFIG_ADDR A:0x41a01a8
y.create.l HWIO_MSS_CXM_RX_STAT_ADDR A:0x41a01ac
y.create.l HWIO_MSS_CXM_DBG_STAT_ADDR A:0x41a01b0
y.create.l HWIO_MSS_CXM_DIR_UART_TR_ADDR A:0x41a01b4
y.create.l HWIO_MSS_CXM_TYP0_RESP_TOUT_DUR_ADDR A:0x41a01b8
y.create.l HWIO_MSS_CXM_TYP0_RESP_STAT_ADDR A:0x41a01bc
y.create.l HWIO_MSS_CXM_WCN_PRIORITY_REG_STAT_ADDR A:0x41a01c0
y.create.l HWIO_MSS_CXM_RX_WCI2_MSG_TYPE0_CONTENT_ADDR A:0x41a01c4
y.create.l HWIO_MSS_CXM_RX_WCI2_MSG_TYPE1_CONTENT_ADDR A:0x41a01c8
y.create.l HWIO_MSS_CXM_RX_WCI2_MSG_TYPE2_CONTENT_ADDR A:0x41a01cc
y.create.l HWIO_MSS_CXM_RX_WCI2_MSG_TYPE3_CONTENT_ADDR A:0x41a01d0
y.create.l HWIO_MSS_CXM_RX_WCI2_MSG_TYPE4_CONTENT_ADDR A:0x41a01d4
y.create.l HWIO_MSS_CXM_RX_WCI2_MSG_TYPE5_CONTENT_ADDR A:0x41a01d8
y.create.l HWIO_MSS_CXM_RX_WCI2_MSG_TYPE6_CONTENT_ADDR A:0x41a01dc
y.create.l HWIO_MSS_CXM_RX_WCI2_MSG_TYPE7_CONTENT_ADDR A:0x41a01e0
y.create.l HWIO_MSS_CXM_SPARE_BITS_ADDR A:0x41a01e4
y.create.l HWIO_MSS_CONF_ABT_HW_VERSION_ADDR A:0x41b0000
y.create.l HWIO_MSS_CONF_ABT_INST_ID_ADDR A:0x41b0004
y.create.l HWIO_MSS_CONF_ABT_NUM_SLAVES_ADDR A:0x41b0008
y.create.l HWIO_MSS_CONF_ABT_TIMER_LOADVAL_ADDR A:0x41b000c
y.create.l HWIO_MSS_CONF_ABT_TIMER_MODE_ADDR A:0x41b0010
y.create.l HWIO_MSS_CONF_ABT_INTR_STATUS_ADDR A:0x41b0014
y.create.l HWIO_MSS_CONF_ABT_INTR_CLEAR_ADDR A:0x41b0018
y.create.l HWIO_MSS_CONF_ABT_INTR_ENABLE_ADDR A:0x41b001c
y.create.l HWIO_MSS_CONF_ABT_SYND_VALID_ADDR A:0x41b0020
y.create.l HWIO_MSS_CONF_ABT_SYND_CLEAR_ADDR A:0x41b0024
y.create.l HWIO_MSS_CONF_ABT_SYND_ID_ADDR A:0x41b0028
y.create.l HWIO_MSS_CONF_ABT_SYND_ADDR0_ADDR A:0x41b002c
y.create.l HWIO_MSS_CONF_ABT_SYND_ADDR1_ADDR A:0x41b0030
y.create.l HWIO_MSS_CONF_ABT_SYND_HREADY_ADDR A:0x41b0034
y.create.l HWIO_COMBODAC_CFG0_0_ADDR A:0x41b2000
y.create.l HWIO_COMBODAC_CFG1_0_ADDR A:0x41b2008
y.create.l HWIO_COMBODAC_CFG2_0_ADDR A:0x41b2010
y.create.l HWIO_COMBODAC_DIGVAL_EN_0_ADDR A:0x41b2020
y.create.l HWIO_COMBODAC_IREF_CTRL_0_ADDR A:0x41b2028
y.create.l HWIO_COMBODAC_CAL_CTRL_0_ADDR A:0x41b2030
y.create.l HWIO_COMBODAC_CAL_STATUS_0_ADDR A:0x41b2038
y.create.l HWIO_COMBODAC_MEM_RW_CTRL_0_ADDR A:0x41b2040
y.create.l HWIO_COMBODAC_MEM_RD_DATA_0_ADDR A:0x41b2048
y.create.l HWIO_COMBODAC_RTUNE_RW_CTRL_0_ADDR A:0x41b2050
y.create.l HWIO_COMBODAC_RTUNE_RD_DATA_0_ADDR A:0x41b2058
y.create.l HWIO_COMBODAC_DEBUG_INR_0_ADDR A:0x41b2060
y.create.l HWIO_COMBODAC_DEBUG_OUTR_0_ADDR A:0x41b2068
y.create.l HWIO_COMBODAC_DEBUG_ING_0_ADDR A:0x41b2070
y.create.l HWIO_COMBODAC_DEBUG_OUTG_0_ADDR A:0x41b2078
y.create.l HWIO_COMBODAC_TEST_CTRL_0_ADDR A:0x41b2080
y.create.l HWIO_COMBODAC_COMP_CMDS_ADDR A:0x41b2090
y.create.l HWIO_COMBODAC_COMP_STATUS_ADDR A:0x41b2094
y.create.l HWIO_COMBODAC_BIST_CFG_ADDR A:0x41b2098
y.create.l HWIO_COMBODAC_COMP_CTRL_ADDR A:0x41b209c
y.create.l HWIO_COMBODAC0_CLK_CFG_ADDR A:0x41b20a0
y.create.l HWIO_COMBODAC1_CLK_CFG_ADDR A:0x41b20a4
y.create.l HWIO_COMBODAC_CLK_SRC_CFG_ADDR A:0x41b20a8
y.create.l HWIO_COMBODAC_TIME_CYCLE_ADDR A:0x41b20ac
y.create.l HWIO_COMBODAC_FSM_STATE_MONIT_ADDR A:0x41b20b0
y.create.l HWIO_COMBODAC_IREF_STATUS_ADDR A:0x41b20b4
y.create.l HWIO_COMBODAC_REGARRAY0_ADDR A:0x41b2800
y.create.l HWIO_COMBODAC_REGARRAY1_ADDR A:0x41b2804
y.create.l HWIO_COMBODAC_REGARRAY2_ADDR A:0x41b2808
y.create.l HWIO_COMBODAC_REGARRAY3_ADDR A:0x41b280c
y.create.l HWIO_COMBODAC_REGARRAY4_ADDR A:0x41b2810
y.create.l HWIO_COMBODAC_REGARRAY5_ADDR A:0x41b2814
y.create.l HWIO_COMBODAC_REGARRAY6_ADDR A:0x41b2818
y.create.l HWIO_COMBODAC_REGARRAY7_ADDR A:0x41b281c
y.create.l HWIO_COMBODAC_REGARRAY8_ADDR A:0x41b2820
y.create.l HWIO_COMBODAC_REGARRAY9_ADDR A:0x41b2824
y.create.l HWIO_MSS_MGPI_PMIC_CONFIG0_ADDR A:0x41b3000
y.create.l HWIO_MSS_MGPI_PMIC_CONFIG1_ADDR A:0x41b3008
y.create.l HWIO_MSS_MGPI_PMIC_CONFIG2_ADDR A:0x41b3010
y.create.l HWIO_MSS_MGPI_PMIC_CONFIG3_ADDR A:0x41b3018
y.create.l HWIO_MSS_MGPI_PMIC_CONFIG4_ADDR A:0x41b3020
y.create.l HWIO_MSS_MGPI_PMIC_CONFIG5_ADDR A:0x41b3028
y.create.l HWIO_MSS_MGPI_PMIC_CONFIG6_ADDR A:0x41b3030
y.create.l HWIO_MSS_MGPI_PMIC_CONFIG7_ADDR A:0x41b3038
y.create.l HWIO_MSS_MGPI_PMIC_CONFIG8_ADDR A:0x41b3040
y.create.l HWIO_MSS_MGPI_PMIC_CONFIG9_ADDR A:0x41b3048
y.create.l HWIO_MSS_MGPI_CONF_STATUS0_ADDR A:0x41b3004
y.create.l HWIO_MSS_MGPI_CONF_STATUS1_ADDR A:0x41b300c
y.create.l HWIO_MSS_MGPI_CONF_STATUS2_ADDR A:0x41b3014
y.create.l HWIO_MSS_MGPI_CONF_STATUS3_ADDR A:0x41b301c
y.create.l HWIO_MSS_MGPI_CONF_STATUS4_ADDR A:0x41b3024
y.create.l HWIO_MSS_MGPI_CONF_STATUS5_ADDR A:0x41b302c
y.create.l HWIO_MSS_MGPI_CONF_STATUS6_ADDR A:0x41b3034
y.create.l HWIO_MSS_MGPI_CONF_STATUS7_ADDR A:0x41b303c
y.create.l HWIO_MSS_MGPI_CONF_STATUS8_ADDR A:0x41b3044
y.create.l HWIO_MSS_MGPI_CONF_STATUS9_ADDR A:0x41b304c
y.create.l HWIO_MSS_MGPI_MASTER_CSR_ADDR A:0x41b3100
y.create.l HWIO_MSS_MGPI_HW_VERSION_ADDR A:0x41b3104
y.create.l HWIO_MSS_CRYPTO_VERSION_ADDR A:0x41fa000
y.create.l HWIO_MSS_CRYPTO_DATA_IN0_ADDR A:0x41fa010
y.create.l HWIO_MSS_CRYPTO_DATA_IN1_ADDR A:0x41fa014
y.create.l HWIO_MSS_CRYPTO_DATA_IN2_ADDR A:0x41fa018
y.create.l HWIO_MSS_CRYPTO_DATA_IN3_ADDR A:0x41fa01c
y.create.l HWIO_MSS_CRYPTO_DATA_OUT0_ADDR A:0x41fa020
y.create.l HWIO_MSS_CRYPTO_DATA_OUT1_ADDR A:0x41fa024
y.create.l HWIO_MSS_CRYPTO_DATA_OUT2_ADDR A:0x41fa028
y.create.l HWIO_MSS_CRYPTO_DATA_OUT3_ADDR A:0x41fa02c
y.create.l HWIO_MSS_CRYPTO_STATUS_ADDR A:0x41fa100
y.create.l HWIO_MSS_CRYPTO_STATUS2_ADDR A:0x41fa104
y.create.l HWIO_MSS_CRYPTO_BIST_STATUS_ADDR A:0x41fa114
y.create.l HWIO_MSS_CRYPTO_BIST_FINISH_ADDR A:0x41fa118
y.create.l HWIO_MSS_CRYPTO_ENGINES_AVAIL_ADDR A:0x41fa108
y.create.l HWIO_MSS_CRYPTO_FIFO_SIZES_ADDR A:0x41fa10c
y.create.l HWIO_MSS_CRYPTO_SEG_SIZE_ADDR A:0x41fa110
y.create.l HWIO_MSS_CRYPTO_GOPROC_ADDR A:0x41fa120
y.create.l HWIO_MSS_CRYPTO_GOPROC_QC_KEY_ADDR A:0x41fb000
y.create.l HWIO_MSS_CRYPTO_GOPROC_OEM_KEY_ADDR A:0x41fc000
y.create.l HWIO_MSS_CRYPTO_ENCR_SEG_CFG_ADDR A:0x41fa200
y.create.l HWIO_MSS_CRYPTO_ENCR_SEG_SIZE_ADDR A:0x41fa204
y.create.l HWIO_MSS_CRYPTO_ENCR_SEG_START_ADDR A:0x41fa208
y.create.l HWIO_MSS_CRYPTO_ENCR_KEY0_ADDR A:0x41fd000
y.create.l HWIO_MSS_CRYPTO_ENCR_KEY1_ADDR A:0x41fd004
y.create.l HWIO_MSS_CRYPTO_ENCR_KEY2_ADDR A:0x41fd008
y.create.l HWIO_MSS_CRYPTO_ENCR_KEY3_ADDR A:0x41fd00c
y.create.l HWIO_MSS_CRYPTO_ENCR_KEY4_ADDR A:0x41fd010
y.create.l HWIO_MSS_CRYPTO_ENCR_KEY5_ADDR A:0x41fd014
y.create.l HWIO_MSS_CRYPTO_ENCR_KEY6_ADDR A:0x41fd018
y.create.l HWIO_MSS_CRYPTO_ENCR_KEY7_ADDR A:0x41fd01c
y.create.l HWIO_MSS_CRYPTO_ENCR_XTS_KEY0_ADDR A:0x41fd020
y.create.l HWIO_MSS_CRYPTO_ENCR_XTS_KEY1_ADDR A:0x41fd024
y.create.l HWIO_MSS_CRYPTO_ENCR_XTS_KEY2_ADDR A:0x41fd028
y.create.l HWIO_MSS_CRYPTO_ENCR_XTS_KEY3_ADDR A:0x41fd02c
y.create.l HWIO_MSS_CRYPTO_ENCR_XTS_KEY4_ADDR A:0x41fd030
y.create.l HWIO_MSS_CRYPTO_ENCR_XTS_KEY5_ADDR A:0x41fd034
y.create.l HWIO_MSS_CRYPTO_ENCR_XTS_KEY6_ADDR A:0x41fd038
y.create.l HWIO_MSS_CRYPTO_ENCR_XTS_KEY7_ADDR A:0x41fd03c
y.create.l HWIO_MSS_CRYPTO_ENCR_CNTR0_IV0_ADDR A:0x41fa20c
y.create.l HWIO_MSS_CRYPTO_ENCR_CNTR1_IV1_ADDR A:0x41fa210
y.create.l HWIO_MSS_CRYPTO_ENCR_CNTR2_IV2_ADDR A:0x41fa214
y.create.l HWIO_MSS_CRYPTO_ENCR_CNTR3_IV3_ADDR A:0x41fa218
y.create.l HWIO_MSS_CRYPTO_ENCR_CNTR_MASK_ADDR A:0x41fa21c
y.create.l HWIO_MSS_CRYPTO_ENCR_CNTR_MASK2_ADDR A:0x41fa234
y.create.l HWIO_MSS_CRYPTO_ENCR_CNTR_MASK1_ADDR A:0x41fa238
y.create.l HWIO_MSS_CRYPTO_ENCR_CNTR_MASK0_ADDR A:0x41fa23c
y.create.l HWIO_MSS_CRYPTO_ENCR_CCM_INIT_CNTR0_ADDR A:0x41fa220
y.create.l HWIO_MSS_CRYPTO_ENCR_CCM_INIT_CNTR1_ADDR A:0x41fa224
y.create.l HWIO_MSS_CRYPTO_ENCR_CCM_INIT_CNTR2_ADDR A:0x41fa228
y.create.l HWIO_MSS_CRYPTO_ENCR_CCM_INIT_CNTR3_ADDR A:0x41fa22c
y.create.l HWIO_MSS_CRYPTO_ENCR_XTS_DU_SIZE_ADDR A:0x41fa230
y.create.l HWIO_MSS_CRYPTO_AUTH_SEG_CFG_ADDR A:0x41fa300
y.create.l HWIO_MSS_CRYPTO_AUTH_SEG_SIZE_ADDR A:0x41fa304
y.create.l HWIO_MSS_CRYPTO_AUTH_SEG_START_ADDR A:0x41fa308
y.create.l HWIO_MSS_CRYPTO_AUTH_KEY0_ADDR A:0x41fd040
y.create.l HWIO_MSS_CRYPTO_AUTH_KEY1_ADDR A:0x41fd044
y.create.l HWIO_MSS_CRYPTO_AUTH_KEY2_ADDR A:0x41fd048
y.create.l HWIO_MSS_CRYPTO_AUTH_KEY3_ADDR A:0x41fd04c
y.create.l HWIO_MSS_CRYPTO_AUTH_KEY4_ADDR A:0x41fd050
y.create.l HWIO_MSS_CRYPTO_AUTH_KEY5_ADDR A:0x41fd054
y.create.l HWIO_MSS_CRYPTO_AUTH_KEY6_ADDR A:0x41fd058
y.create.l HWIO_MSS_CRYPTO_AUTH_KEY7_ADDR A:0x41fd05c
y.create.l HWIO_MSS_CRYPTO_AUTH_KEY8_ADDR A:0x41fd060
y.create.l HWIO_MSS_CRYPTO_AUTH_KEY9_ADDR A:0x41fd064
y.create.l HWIO_MSS_CRYPTO_AUTH_IV0_ADDR A:0x41fa310
y.create.l HWIO_MSS_CRYPTO_AUTH_IV1_ADDR A:0x41fa314
y.create.l HWIO_MSS_CRYPTO_AUTH_IV2_ADDR A:0x41fa318
y.create.l HWIO_MSS_CRYPTO_AUTH_IV3_ADDR A:0x41fa31c
y.create.l HWIO_MSS_CRYPTO_AUTH_IV4_ADDR A:0x41fa320
y.create.l HWIO_MSS_CRYPTO_AUTH_IV5_ADDR A:0x41fa324
y.create.l HWIO_MSS_CRYPTO_AUTH_IV6_ADDR A:0x41fa328
y.create.l HWIO_MSS_CRYPTO_AUTH_IV7_ADDR A:0x41fa32c
y.create.l HWIO_MSS_CRYPTO_AUTH_INFO_NONCE0_ADDR A:0x41fa350
y.create.l HWIO_MSS_CRYPTO_AUTH_INFO_NONCE1_ADDR A:0x41fa354
y.create.l HWIO_MSS_CRYPTO_AUTH_INFO_NONCE2_ADDR A:0x41fa358
y.create.l HWIO_MSS_CRYPTO_AUTH_INFO_NONCE3_ADDR A:0x41fa35c
y.create.l HWIO_MSS_CRYPTO_AUTH_BYTECNT0_ADDR A:0x41fa390
y.create.l HWIO_MSS_CRYPTO_AUTH_BYTECNT1_ADDR A:0x41fa394
y.create.l HWIO_MSS_CRYPTO_AUTH_EXP_MAC0_ADDR A:0x41fa3a0
y.create.l HWIO_MSS_CRYPTO_AUTH_EXP_MAC1_ADDR A:0x41fa3a4
y.create.l HWIO_MSS_CRYPTO_AUTH_EXP_MAC2_ADDR A:0x41fa3a8
y.create.l HWIO_MSS_CRYPTO_AUTH_EXP_MAC3_ADDR A:0x41fa3ac
y.create.l HWIO_MSS_CRYPTO_AUTH_EXP_MAC4_ADDR A:0x41fa3b0
y.create.l HWIO_MSS_CRYPTO_AUTH_EXP_MAC5_ADDR A:0x41fa3b4
y.create.l HWIO_MSS_CRYPTO_AUTH_EXP_MAC6_ADDR A:0x41fa3b8
y.create.l HWIO_MSS_CRYPTO_AUTH_EXP_MAC7_ADDR A:0x41fa3bc
y.create.l HWIO_MSS_CRYPTO_CONFIG_ADDR A:0x41fa400
y.create.l HWIO_MSS_CRYPTO_DEBUG_ENABLE_ADDR A:0x41ff000
y.create.l HWIO_MSS_CRYPTO_DEBUG_ADDR A:0x41ff004
y.create.l HWIO_MSS_CRYPTO_PWR_CTRL_ADDR A:0x41ff008
y.create.l HWIO_MSS_CRYPTO_BAM_CTRL_ADDR A:0x41c4000
y.create.l HWIO_MSS_CRYPTO_BAM_TIMER_ADDR A:0x41c4040
y.create.l HWIO_MSS_CRYPTO_BAM_TIMER_CTRL_ADDR A:0x41c4044
y.create.l HWIO_MSS_CRYPTO_BAM_DESC_CNT_TRSHLD_ADDR A:0x41c4008
y.create.l HWIO_MSS_CRYPTO_BAM_IRQ_STTS_ADDR A:0x41c4014
y.create.l HWIO_MSS_CRYPTO_BAM_IRQ_CLR_ADDR A:0x41c4018
y.create.l HWIO_MSS_CRYPTO_BAM_IRQ_EN_ADDR A:0x41c401c
y.create.l HWIO_MSS_CRYPTO_BAM_CNFG_BITS_ADDR A:0x41c407c
y.create.l HWIO_MSS_CRYPTO_BAM_CNFG_BITS_2_ADDR A:0x41c4084
y.create.l HWIO_MSS_CRYPTO_BAM_REVISION_ADDR A:0x41c5000
y.create.l HWIO_MSS_CRYPTO_BAM_SW_VERSION_ADDR A:0x41c5004
y.create.l HWIO_MSS_CRYPTO_BAM_NUM_PIPES_ADDR A:0x41c5008
y.create.l HWIO_MSS_CRYPTO_BAM_TEST_BUS_SEL_ADDR A:0x41c5010
y.create.l HWIO_MSS_CRYPTO_BAM_TEST_BUS_REG_ADDR A:0x41c5014
y.create.l HWIO_MSS_CRYPTO_BAM_AHB_MASTER_ERR_CTRLS_ADDR A:0x41c5024
y.create.l HWIO_MSS_CRYPTO_BAM_AHB_MASTER_ERR_ADDR_ADDR A:0x41c5028
y.create.l HWIO_MSS_CRYPTO_BAM_AHB_MASTER_ERR_DATA_ADDR A:0x41c502c
y.create.l HWIO_MSS_CRYPTO_BAM_AHB_MASTER_ERR_ADDR_LSB_ADDR A:0x41c5100
y.create.l HWIO_MSS_CRYPTO_BAM_AHB_MASTER_ERR_ADDR_MSB_ADDR A:0x41c5104
y.create.l HWIO_MSS_CRYPTO_BAM_TRUST_REG_ADDR A:0x41c6000
y.create.l HWIO_MSS_CRYPTO_BAM_P_TRUST_REG0_ADDR A:0x41c6020
y.create.l HWIO_MSS_CRYPTO_BAM_P_TRUST_REG1_ADDR A:0x41c6024
y.create.l HWIO_MSS_CRYPTO_BAM_IRQ_SRCS_EE0_ADDR A:0x41c7000
y.create.l HWIO_MSS_CRYPTO_BAM_IRQ_SRCS_EE1_ADDR A:0x41c8000
y.create.l HWIO_MSS_CRYPTO_BAM_IRQ_SRCS_EE2_ADDR A:0x41c9000
y.create.l HWIO_MSS_CRYPTO_BAM_IRQ_SRCS_EE3_ADDR A:0x41ca000
y.create.l HWIO_MSS_CRYPTO_BAM_IRQ_SRCS_EE4_ADDR A:0x41cb000
y.create.l HWIO_MSS_CRYPTO_BAM_IRQ_SRCS_EE5_ADDR A:0x41cc000
y.create.l HWIO_MSS_CRYPTO_BAM_IRQ_SRCS_EE6_ADDR A:0x41cd000
y.create.l HWIO_MSS_CRYPTO_BAM_IRQ_SRCS_EE7_ADDR A:0x41ce000
y.create.l HWIO_MSS_CRYPTO_BAM_IRQ_SRCS_MSK_EE0_ADDR A:0x41c7004
y.create.l HWIO_MSS_CRYPTO_BAM_IRQ_SRCS_MSK_EE1_ADDR A:0x41c8004
y.create.l HWIO_MSS_CRYPTO_BAM_IRQ_SRCS_MSK_EE2_ADDR A:0x41c9004
y.create.l HWIO_MSS_CRYPTO_BAM_IRQ_SRCS_MSK_EE3_ADDR A:0x41ca004
y.create.l HWIO_MSS_CRYPTO_BAM_IRQ_SRCS_MSK_EE4_ADDR A:0x41cb004
y.create.l HWIO_MSS_CRYPTO_BAM_IRQ_SRCS_MSK_EE5_ADDR A:0x41cc004
y.create.l HWIO_MSS_CRYPTO_BAM_IRQ_SRCS_MSK_EE6_ADDR A:0x41cd004
y.create.l HWIO_MSS_CRYPTO_BAM_IRQ_SRCS_MSK_EE7_ADDR A:0x41ce004
y.create.l HWIO_MSS_CRYPTO_BAM_IRQ_SRCS_UNMASKED_EE0_ADDR A:0x41c7008
y.create.l HWIO_MSS_CRYPTO_BAM_IRQ_SRCS_UNMASKED_EE1_ADDR A:0x41c8008
y.create.l HWIO_MSS_CRYPTO_BAM_IRQ_SRCS_UNMASKED_EE2_ADDR A:0x41c9008
y.create.l HWIO_MSS_CRYPTO_BAM_IRQ_SRCS_UNMASKED_EE3_ADDR A:0x41ca008
y.create.l HWIO_MSS_CRYPTO_BAM_IRQ_SRCS_UNMASKED_EE4_ADDR A:0x41cb008
y.create.l HWIO_MSS_CRYPTO_BAM_IRQ_SRCS_UNMASKED_EE5_ADDR A:0x41cc008
y.create.l HWIO_MSS_CRYPTO_BAM_IRQ_SRCS_UNMASKED_EE6_ADDR A:0x41cd008
y.create.l HWIO_MSS_CRYPTO_BAM_IRQ_SRCS_UNMASKED_EE7_ADDR A:0x41ce008
y.create.l HWIO_MSS_CRYPTO_BAM_PIPE_ATTR_EE0_ADDR A:0x41c700c
y.create.l HWIO_MSS_CRYPTO_BAM_PIPE_ATTR_EE1_ADDR A:0x41c800c
y.create.l HWIO_MSS_CRYPTO_BAM_PIPE_ATTR_EE2_ADDR A:0x41c900c
y.create.l HWIO_MSS_CRYPTO_BAM_PIPE_ATTR_EE3_ADDR A:0x41ca00c
y.create.l HWIO_MSS_CRYPTO_BAM_PIPE_ATTR_EE4_ADDR A:0x41cb00c
y.create.l HWIO_MSS_CRYPTO_BAM_PIPE_ATTR_EE5_ADDR A:0x41cc00c
y.create.l HWIO_MSS_CRYPTO_BAM_PIPE_ATTR_EE6_ADDR A:0x41cd00c
y.create.l HWIO_MSS_CRYPTO_BAM_PIPE_ATTR_EE7_ADDR A:0x41ce00c
y.create.l HWIO_MSS_CRYPTO_BAM_IRQ_SRCS_ADDR A:0x41c7010
y.create.l HWIO_MSS_CRYPTO_BAM_IRQ_SRCS_MSK_ADDR A:0x41c7014
y.create.l HWIO_MSS_CRYPTO_BAM_IRQ_SRCS_UNMASKED_ADDR A:0x41c7018
y.create.l HWIO_MSS_CRYPTO_BAM_P_CTRL0_ADDR A:0x41d7000
y.create.l HWIO_MSS_CRYPTO_BAM_P_CTRL1_ADDR A:0x41d8000
y.create.l HWIO_MSS_CRYPTO_BAM_P_RST0_ADDR A:0x41d7004
y.create.l HWIO_MSS_CRYPTO_BAM_P_RST1_ADDR A:0x41d8004
y.create.l HWIO_MSS_CRYPTO_BAM_P_HALT0_ADDR A:0x41d7008
y.create.l HWIO_MSS_CRYPTO_BAM_P_HALT1_ADDR A:0x41d8008
y.create.l HWIO_MSS_CRYPTO_BAM_P_IRQ_STTS0_ADDR A:0x41d7010
y.create.l HWIO_MSS_CRYPTO_BAM_P_IRQ_STTS1_ADDR A:0x41d8010
y.create.l HWIO_MSS_CRYPTO_BAM_P_IRQ_CLR0_ADDR A:0x41d7014
y.create.l HWIO_MSS_CRYPTO_BAM_P_IRQ_CLR1_ADDR A:0x41d8014
y.create.l HWIO_MSS_CRYPTO_BAM_P_IRQ_EN0_ADDR A:0x41d7018
y.create.l HWIO_MSS_CRYPTO_BAM_P_IRQ_EN1_ADDR A:0x41d8018
y.create.l HWIO_MSS_CRYPTO_BAM_P_TIMER0_ADDR A:0x41d701c
y.create.l HWIO_MSS_CRYPTO_BAM_P_TIMER1_ADDR A:0x41d801c
y.create.l HWIO_MSS_CRYPTO_BAM_P_TIMER_CTRL0_ADDR A:0x41d7020
y.create.l HWIO_MSS_CRYPTO_BAM_P_TIMER_CTRL1_ADDR A:0x41d8020
y.create.l HWIO_MSS_CRYPTO_BAM_P_PRDCR_SDBND0_ADDR A:0x41d7024
y.create.l HWIO_MSS_CRYPTO_BAM_P_PRDCR_SDBND1_ADDR A:0x41d8024
y.create.l HWIO_MSS_CRYPTO_BAM_P_CNSMR_SDBND0_ADDR A:0x41d7028
y.create.l HWIO_MSS_CRYPTO_BAM_P_CNSMR_SDBND1_ADDR A:0x41d8028
y.create.l HWIO_MSS_CRYPTO_BAM_P_SW_OFSTS0_ADDR A:0x41d7800
y.create.l HWIO_MSS_CRYPTO_BAM_P_SW_OFSTS1_ADDR A:0x41d8800
y.create.l HWIO_MSS_CRYPTO_BAM_P_AU_PSM_CNTXT_1_0_ADDR A:0x41d7804
y.create.l HWIO_MSS_CRYPTO_BAM_P_AU_PSM_CNTXT_1_1_ADDR A:0x41d8804
y.create.l HWIO_MSS_CRYPTO_BAM_P_PSM_CNTXT_2_0_ADDR A:0x41d7808
y.create.l HWIO_MSS_CRYPTO_BAM_P_PSM_CNTXT_2_1_ADDR A:0x41d8808
y.create.l HWIO_MSS_CRYPTO_BAM_P_PSM_CNTXT_3_0_ADDR A:0x41d780c
y.create.l HWIO_MSS_CRYPTO_BAM_P_PSM_CNTXT_3_1_ADDR A:0x41d880c
y.create.l HWIO_MSS_CRYPTO_BAM_P_PSM_CNTXT_4_0_ADDR A:0x41d7810
y.create.l HWIO_MSS_CRYPTO_BAM_P_PSM_CNTXT_4_1_ADDR A:0x41d8810
y.create.l HWIO_MSS_CRYPTO_BAM_P_PSM_CNTXT_5_0_ADDR A:0x41d7814
y.create.l HWIO_MSS_CRYPTO_BAM_P_PSM_CNTXT_5_1_ADDR A:0x41d8814
y.create.l HWIO_MSS_CRYPTO_BAM_P_EVNT_REG0_ADDR A:0x41d7818
y.create.l HWIO_MSS_CRYPTO_BAM_P_EVNT_REG1_ADDR A:0x41d8818
y.create.l HWIO_MSS_CRYPTO_BAM_P_DESC_FIFO_ADDR0_ADDR A:0x41d781c
y.create.l HWIO_MSS_CRYPTO_BAM_P_DESC_FIFO_ADDR1_ADDR A:0x41d881c
y.create.l HWIO_MSS_CRYPTO_BAM_P_FIFO_SIZES0_ADDR A:0x41d7820
y.create.l HWIO_MSS_CRYPTO_BAM_P_FIFO_SIZES1_ADDR A:0x41d8820
y.create.l HWIO_MSS_CRYPTO_BAM_P_DATA_FIFO_ADDR0_ADDR A:0x41d7824
y.create.l HWIO_MSS_CRYPTO_BAM_P_DATA_FIFO_ADDR1_ADDR A:0x41d8824
y.create.l HWIO_MSS_CRYPTO_BAM_P_EVNT_GEN_TRSHLD0_ADDR A:0x41d7828
y.create.l HWIO_MSS_CRYPTO_BAM_P_EVNT_GEN_TRSHLD1_ADDR A:0x41d8828
y.create.l HWIO_MSS_CRYPTO_BAM_P_EVNT_DEST_ADDR0_ADDR A:0x41d782c
y.create.l HWIO_MSS_CRYPTO_BAM_P_EVNT_DEST_ADDR1_ADDR A:0x41d882c
y.create.l HWIO_MSS_CRYPTO_BAM_P_DF_CNTXT_0_ADDR A:0x41d7830
y.create.l HWIO_MSS_CRYPTO_BAM_P_DF_CNTXT_1_ADDR A:0x41d8830
y.create.l HWIO_MSS_CRYPTO_BAM_P_RETR_CNTXT_0_ADDR A:0x41d7834
y.create.l HWIO_MSS_CRYPTO_BAM_P_RETR_CNTXT_1_ADDR A:0x41d8834
y.create.l HWIO_MSS_CRYPTO_BAM_P_SI_CNTXT_0_ADDR A:0x41d7838
y.create.l HWIO_MSS_CRYPTO_BAM_P_SI_CNTXT_1_ADDR A:0x41d8838
y.create.l HWIO_MSS_CRYPTO_BAM_P_PSM_CNTXT_3_LSB0_ADDR A:0x41d7900
y.create.l HWIO_MSS_CRYPTO_BAM_P_PSM_CNTXT_3_LSB1_ADDR A:0x41d8900
y.create.l HWIO_MSS_CRYPTO_BAM_P_PSM_CNTXT_3_MSB0_ADDR A:0x41d7904
y.create.l HWIO_MSS_CRYPTO_BAM_P_PSM_CNTXT_3_MSB1_ADDR A:0x41d8904
y.create.l HWIO_MSS_CRYPTO_BAM_P_DESC_FIFO_ADDR_LSB0_ADDR A:0x41d7910
y.create.l HWIO_MSS_CRYPTO_BAM_P_DESC_FIFO_ADDR_LSB1_ADDR A:0x41d8910
y.create.l HWIO_MSS_CRYPTO_BAM_P_DESC_FIFO_ADDR_MSB0_ADDR A:0x41d7914
y.create.l HWIO_MSS_CRYPTO_BAM_P_DESC_FIFO_ADDR_MSB1_ADDR A:0x41d8914
y.create.l HWIO_MSS_CRYPTO_BAM_P_DATA_FIFO_ADDR_LSB0_ADDR A:0x41d7920
y.create.l HWIO_MSS_CRYPTO_BAM_P_DATA_FIFO_ADDR_LSB1_ADDR A:0x41d8920
y.create.l HWIO_MSS_CRYPTO_BAM_P_DATA_FIFO_ADDR_MSB0_ADDR A:0x41d7924
y.create.l HWIO_MSS_CRYPTO_BAM_P_DATA_FIFO_ADDR_MSB1_ADDR A:0x41d8924
y.create.l HWIO_MSS_CRYPTO_BAM_P_EVNT_DEST_ADDR_LSB0_ADDR A:0x41d7930
y.create.l HWIO_MSS_CRYPTO_BAM_P_EVNT_DEST_ADDR_LSB1_ADDR A:0x41d8930
y.create.l HWIO_MSS_CRYPTO_BAM_P_EVNT_DEST_ADDR_MSB0_ADDR A:0x41d7934
y.create.l HWIO_MSS_CRYPTO_BAM_P_EVNT_DEST_ADDR_MSB1_ADDR A:0x41d8934
y.create.l HWIO_MSS_RC_CONTROL_ADDR A:0x4200000
y.create.l HWIO_MSS_RC_CONFIG_ADDR A:0x4200004
y.create.l HWIO_MSS_RC_LPM_RTC_CONTROL_ADDR A:0x4200008
y.create.l HWIO_MSS_RC_PPSO_ASSERT_ADDR A:0x420000c
y.create.l HWIO_MSS_RC_PPSO_DEASSERT_ADDR A:0x4200010
y.create.l HWIO_MSS_RC_GPS_ON_ADDR A:0x4200014
y.create.l HWIO_MSS_RC_TIME_TRANSFER_ADDR A:0x4200018
y.create.l HWIO_MSS_RC_GNSS_RTC_STATUS_ADDR A:0x420001c
y.create.l HWIO_MSS_RC_BP1_COUNT_STATUS_ADDR A:0x4200020
y.create.l HWIO_MSS_RC_BP1_PHASE_STATUS_ADDR A:0x4200024
y.create.l HWIO_MSS_RC_BP2_COUNT_STATUS_ADDR A:0x4200028
y.create.l HWIO_MSS_RC_BP2_PHASE_STATUS_ADDR A:0x420002c
y.create.l HWIO_MSS_RC_BP3_COUNT_STATUS_ADDR A:0x4200030
y.create.l HWIO_MSS_RC_BP3_PHASE_STATUS_ADDR A:0x4200034
y.create.l HWIO_MSS_RC_BP4_COUNT_STATUS_ADDR A:0x4200038
y.create.l HWIO_MSS_RC_BP4_PHASE_STATUS_ADDR A:0x420003c
y.create.l HWIO_MSS_RC_TT_STATUS_ADDR A:0x4200040
y.create.l HWIO_MSS_RC_IRQ_STATUS_ADDR A:0x4200044
y.create.l HWIO_MSS_RC_PPSI_RTC_ADDR A:0x4200048
y.create.l HWIO_MSS_RC_NAV_TT_RTC_ADDR A:0x420004c
y.create.l HWIO_MSS_RC_CDMA_TT_RTC_ADDR A:0x4200050
y.create.l HWIO_MSS_RC_GNSS_TT_CNT_ADDR A:0x4200054
y.create.l HWIO_MSS_RC_NAV_TEST_BUS_ADDR A:0x4200058
y.create.l HWIO_MSS_RC_B1_POLYNOMIAL_MASK_ADDR A:0x420005c
y.create.l HWIO_MSS_AD_MODE_ADDR A:0x4200080
y.create.l HWIO_MSS_AD_RX1_CONFIG_ADDR A:0x4200084
y.create.l HWIO_MSS_AD_RX2_CONFIG_ADDR A:0x4200088
y.create.l HWIO_MSS_AD_RX1_QUANTMAP_ADDR A:0x420008c
y.create.l HWIO_MSS_AD_RX2_QUANTMAP_ADDR A:0x4200090
y.create.l HWIO_MSS_AD_MEAS_STATUS_ADDR A:0x4200094
y.create.l HWIO_MSS_AD_RX1_MEAN_MON_ADDR A:0x4200098
y.create.l HWIO_MSS_AD_RX2_MEAN_MON_ADDR A:0x420009c
y.create.l HWIO_MSS_AD_RX1_BLANK_MONITOR_ADDR A:0x42000a0
y.create.l HWIO_MSS_AD_RX2_BLANK_MONITOR_ADDR A:0x42000a4
y.create.l HWIO_MSS_AD_SL_INDEX_ADDR A:0x42000a8
y.create.l HWIO_MSS_AD_RX1_AMPL_MON_ADDR A:0x42000ac
y.create.l HWIO_MSS_AD_RX2_AMPL_MON_ADDR A:0x42000b0
y.create.l HWIO_MSS_AD_SPEC_ANALYZER_CMD_ADDR A:0x42000b4
y.create.l HWIO_MSS_AD_SPEC_ANALYZER_STATUS_ADDR A:0x42000b8
y.create.l HWIO_MSS_BP1_CONFIG_ADDR A:0x4200200
y.create.l HWIO_MSS_BP1_IF_FREQ_ADDR A:0x4200204
y.create.l HWIO_MSS_BP1_RS_RATE_ADDR A:0x4200208
y.create.l HWIO_MSS_BP1_OFFSET_ADDR A:0x420020c
y.create.l HWIO_MSS_BP1_NOTCH1_ADDR A:0x4200210
y.create.l HWIO_MSS_BP1_NOTCH2_ADDR A:0x4200214
y.create.l HWIO_MSS_BP1_NOTCH3_ADDR A:0x4200218
y.create.l HWIO_MSS_BP1_NOTCH4_ADDR A:0x420021c
y.create.l HWIO_MSS_BP1_NOTCH5_ADDR A:0x4200220
y.create.l HWIO_MSS_BP1_NOTCH6_ADDR A:0x4200224
y.create.l HWIO_MSS_BP1_EQ_COEF_REAL_ADDR A:0x4200228
y.create.l HWIO_MSS_BP1_EQ_COEF_IMAG_ADDR A:0x420022c
y.create.l HWIO_MSS_BP1_FREQ_ADDR A:0x4200230
y.create.l HWIO_MSS_BP1_THRESH_ADDR A:0x4200234
y.create.l HWIO_MSS_BP1_PRE_NOTCH_ADDR A:0x4200238
y.create.l HWIO_MSS_BP1_RS_PHASE_ADDR A:0x420023c
y.create.l HWIO_MSS_BP1_PRE_AMPL_MON_ADDR A:0x4200240
y.create.l HWIO_MSS_BP1_MEAN_MON_ADDR A:0x4200244
y.create.l HWIO_MSS_BP1_SCH2_AMPL_MON_ADDR A:0x4200248
y.create.l HWIO_MSS_BP1_SCH3_AMPL_MON_ADDR A:0x420024c
y.create.l HWIO_MSS_BP2_CONFIG_ADDR A:0x4200300
y.create.l HWIO_MSS_BP2_IF_FREQ_ADDR A:0x4200304
y.create.l HWIO_MSS_BP2_RS_RATE_ADDR A:0x4200308
y.create.l HWIO_MSS_BP2_OFFSET_ADDR A:0x420030c
y.create.l HWIO_MSS_BP2_NOTCH1_ADDR A:0x4200310
y.create.l HWIO_MSS_BP2_NOTCH2_ADDR A:0x4200314
y.create.l HWIO_MSS_BP2_NOTCH3_ADDR A:0x4200318
y.create.l HWIO_MSS_BP2_NOTCH4_ADDR A:0x420031c
y.create.l HWIO_MSS_BP2_NOTCH5_ADDR A:0x4200320
y.create.l HWIO_MSS_BP2_NOTCH6_ADDR A:0x4200324
y.create.l HWIO_MSS_BP2_EQ_COEF_REAL_ADDR A:0x4200328
y.create.l HWIO_MSS_BP2_EQ_COEF_IMAG_ADDR A:0x420032c
y.create.l HWIO_MSS_BP2_FREQ_ADDR A:0x4200330
y.create.l HWIO_MSS_BP2_THRESH_ADDR A:0x4200334
y.create.l HWIO_MSS_BP2_PRE_NOTCH_ADDR A:0x4200338
y.create.l HWIO_MSS_BP2_RS_PHASE_ADDR A:0x420033c
y.create.l HWIO_MSS_BP2_PRE_AMPL_MON_ADDR A:0x4200340
y.create.l HWIO_MSS_BP2_MEAN_MON_ADDR A:0x4200344
y.create.l HWIO_MSS_BP2_SCH2_AMPL_MON_ADDR A:0x4200348
y.create.l HWIO_MSS_BP2_SCH3_AMPL_MON_ADDR A:0x420034c
y.create.l HWIO_MSS_BP3_CONFIG_ADDR A:0x4200400
y.create.l HWIO_MSS_BP3_IF_FREQ_ADDR A:0x4200404
y.create.l HWIO_MSS_BP3_RS_RATE_ADDR A:0x4200408
y.create.l HWIO_MSS_BP3_OFFSET_ADDR A:0x420040c
y.create.l HWIO_MSS_BP3_NOTCH1_ADDR A:0x4200410
y.create.l HWIO_MSS_BP3_NOTCH2_ADDR A:0x4200414
y.create.l HWIO_MSS_BP3_NOTCH3_ADDR A:0x4200418
y.create.l HWIO_MSS_BP3_NOTCH4_ADDR A:0x420041c
y.create.l HWIO_MSS_BP3_NOTCH5_ADDR A:0x4200420
y.create.l HWIO_MSS_BP3_NOTCH6_ADDR A:0x4200424
y.create.l HWIO_MSS_BP3_EQ_COEF_REAL_ADDR A:0x4200428
y.create.l HWIO_MSS_BP3_EQ_COEF_IMAG_ADDR A:0x420042c
y.create.l HWIO_MSS_BP3_RS_PHASE_ADDR A:0x4200430
y.create.l HWIO_MSS_BP3_SCH1_FREQ_ADDR A:0x4200434
y.create.l HWIO_MSS_BP3_SCH2_FREQ_ADDR A:0x4200438
y.create.l HWIO_MSS_BP3_SCH3_FREQ_ADDR A:0x420043c
y.create.l HWIO_MSS_BP3_SCH4_FREQ_ADDR A:0x4200440
y.create.l HWIO_MSS_BP3_SCH5_FREQ_ADDR A:0x4200444
y.create.l HWIO_MSS_BP3_SCH6_FREQ_ADDR A:0x4200448
y.create.l HWIO_MSS_BP3_SCH7_FREQ_ADDR A:0x420044c
y.create.l HWIO_MSS_BP3_SCH8_FREQ_ADDR A:0x4200450
y.create.l HWIO_MSS_BP3_SCH9_FREQ_ADDR A:0x4200454
y.create.l HWIO_MSS_BP3_SCH10_FREQ_ADDR A:0x4200458
y.create.l HWIO_MSS_BP3_SCH11_FREQ_ADDR A:0x420045c
y.create.l HWIO_MSS_BP3_SCH12_FREQ_ADDR A:0x4200460
y.create.l HWIO_MSS_BP3_THRESH_A_ADDR A:0x4200464
y.create.l HWIO_MSS_BP3_THRESH_B_ADDR A:0x4200468
y.create.l HWIO_MSS_BP3_THRESH_C_ADDR A:0x420046c
y.create.l HWIO_MSS_BP3_THRESH_D_ADDR A:0x4200470
y.create.l HWIO_MSS_BP3_THRESH_E_ADDR A:0x4200474
y.create.l HWIO_MSS_BP3_THRESH_F_ADDR A:0x4200478
y.create.l HWIO_MSS_BP3_PRE_AMPL_MON_ADDR A:0x420047c
y.create.l HWIO_MSS_BP3_MEAN_MON_ADDR A:0x4200480
y.create.l HWIO_MSS_BP3_SCH1_AMPL_MON_ADDR A:0x4200484
y.create.l HWIO_MSS_BP3_SCH2_AMPL_MON_ADDR A:0x4200488
y.create.l HWIO_MSS_BP3_SCH3_AMPL_MON_ADDR A:0x420048c
y.create.l HWIO_MSS_BP3_SCH4_AMPL_MON_ADDR A:0x4200490
y.create.l HWIO_MSS_BP3_SCH5_AMPL_MON_ADDR A:0x4200494
y.create.l HWIO_MSS_BP3_SCH6_AMPL_MON_ADDR A:0x4200498
y.create.l HWIO_MSS_BP3_SCH7_AMPL_MON_ADDR A:0x420049c
y.create.l HWIO_MSS_BP3_SCH8_AMPL_MON_ADDR A:0x42004a0
y.create.l HWIO_MSS_BP3_SCH9_AMPL_MON_ADDR A:0x42004a4
y.create.l HWIO_MSS_BP3_SCH10_AMPL_MON_ADDR A:0x42004a8
y.create.l HWIO_MSS_BP3_SCH11_AMPL_MON_ADDR A:0x42004ac
y.create.l HWIO_MSS_BP3_SCH12_AMPL_MON_ADDR A:0x42004b0
y.create.l HWIO_MSS_BP3_SCH_MODE_ADDR A:0x42004b4
y.create.l HWIO_MSS_BP3_PRE_NOTCH_ADDR A:0x42004b8
y.create.l HWIO_MSS_BP3_NOTCH7_ADDR A:0x42004bc
y.create.l HWIO_MSS_BP3_NOTCH8_ADDR A:0x42004c0
y.create.l HWIO_MSS_BP3_NOTCH9_ADDR A:0x42004c4
y.create.l HWIO_MSS_BP3_NOTCH10_ADDR A:0x42004c8
y.create.l HWIO_MSS_BP3_NOTCH11_ADDR A:0x42004cc
y.create.l HWIO_MSS_BP3_NOTCH12_ADDR A:0x42004d0
y.create.l HWIO_MSS_BP4_CONFIG_ADDR A:0x4200500
y.create.l HWIO_MSS_BP4_IF_FREQ_ADDR A:0x4200504
y.create.l HWIO_MSS_BP4_RS_RATE_ADDR A:0x4200508
y.create.l HWIO_MSS_BP4_OFFSET_ADDR A:0x420050c
y.create.l HWIO_MSS_BP4_NOTCH1_ADDR A:0x4200510
y.create.l HWIO_MSS_BP4_NOTCH2_ADDR A:0x4200514
y.create.l HWIO_MSS_BP4_NOTCH3_ADDR A:0x4200518
y.create.l HWIO_MSS_BP4_NOTCH4_ADDR A:0x420051c
y.create.l HWIO_MSS_BP4_NOTCH5_ADDR A:0x4200520
y.create.l HWIO_MSS_BP4_NOTCH6_ADDR A:0x4200524
y.create.l HWIO_MSS_BP4_EQ_COEF_REAL_ADDR A:0x4200528
y.create.l HWIO_MSS_BP4_EQ_COEF_IMAG_ADDR A:0x420052c
y.create.l HWIO_MSS_BP4_FREQ_ADDR A:0x4200530
y.create.l HWIO_MSS_BP4_THRESH_ADDR A:0x4200534
y.create.l HWIO_MSS_BP4_RS_PHASE_ADDR A:0x4200538
y.create.l HWIO_MSS_BP4_PRE_AMPL_MON_ADDR A:0x420053c
y.create.l HWIO_MSS_BP4_MEAN_MON_ADDR A:0x4200540
y.create.l HWIO_MSS_BP4_AMPL_MON_ADDR A:0x4200544
y.create.l HWIO_MSS_BP4_PRE_NOTCH_ADDR A:0x4200548
y.create.l HWIO_MSS_LTE1_CONFIG_ADDR A:0x42002e0
y.create.l HWIO_MSS_LTE1_IF_FREQ_ADDR A:0x42002e4
y.create.l HWIO_MSS_LTE3_CONFIG_ADDR A:0x42004e0
y.create.l HWIO_MSS_LTE3_IF_FREQ_ADDR A:0x42004e4
y.create.l HWIO_MSS_TSG_CMD0_ADDR A:0x4200100
y.create.l HWIO_MSS_TSG_CH1_CONFIG_ADDR A:0x4200104
y.create.l HWIO_MSS_TSG_CH1_RS_RATE_ADDR A:0x4200108
y.create.l HWIO_MSS_TSG_CH1_INIT_COUNT_ADDR A:0x420010c
y.create.l HWIO_MSS_TSG_CH1_FREQ_ADDR A:0x4200110
y.create.l HWIO_MSS_TSG_CH1_DATA_SEED_ADDR A:0x4200114
y.create.l HWIO_MSS_TSG_CH1_PILOT_SEED_ADDR A:0x4200118
y.create.l HWIO_MSS_TSG_CH2_CONFIG_ADDR A:0x420011c
y.create.l HWIO_MSS_TSG_CH2_RS_RATE_ADDR A:0x4200120
y.create.l HWIO_MSS_TSG_CH2_INIT_COUNT_ADDR A:0x4200124
y.create.l HWIO_MSS_TSG_CH2_FREQ_ADDR A:0x4200128
y.create.l HWIO_MSS_TSG_CH2_DATA_SEED_ADDR A:0x420012c
y.create.l HWIO_MSS_TSG_CH2_PILOT_SEED_ADDR A:0x4200130
y.create.l HWIO_MSS_TSG_RX1_CONFIG_ADDR A:0x4200134
y.create.l HWIO_MSS_TSG_RX1_OFFSET_ADDR A:0x4200138
y.create.l HWIO_MSS_TSG_RX2_CONFIG_ADDR A:0x420013c
y.create.l HWIO_MSS_TSG_RX2_OFFSET_ADDR A:0x4200140
y.create.l HWIO_MSS_TSG_FIRST_CODE_ADDR A:0x4200144
y.create.l HWIO_MSS_TSG_CH1_COUNT_STATUS_ADDR A:0x4200148
y.create.l HWIO_MSS_TSG_CH2_COUNT_STATUS_ADDR A:0x420014c
y.create.l HWIO_MSS_SMI_MODE_ADDR A:0x4200600
y.create.l HWIO_MSS_SMI_BASEADDR1_ADDR A:0x4200604
y.create.l HWIO_MSS_SMI_BASEADDR2_ADDR A:0x4200608
y.create.l HWIO_MSS_SMI_BASEADDR3A_ADDR A:0x420060c
y.create.l HWIO_MSS_SMI_BASEADDR3B_ADDR A:0x4200610
y.create.l HWIO_MSS_SMI_BASEADDR3C_ADDR A:0x4200614
y.create.l HWIO_MSS_SMI_BASEADDR4_ADDR A:0x4200618
y.create.l HWIO_MSS_CP_START_ADDR A:0x4200700
y.create.l HWIO_MSS_CP_CONFIG1_ADDR A:0x4200704
y.create.l HWIO_MSS_CP_CONFIG2_ADDR A:0x4200708
y.create.l HWIO_MSS_CP_SAMPLE_INDEX_ADDR A:0x420070c
y.create.l HWIO_MSS_CP_PHASE_ADDR A:0x4200710
y.create.l HWIO_MSS_CP_FREQ_ADDR A:0x4200714
y.create.l HWIO_MSS_CP_DATA_SEED_ADDR A:0x4200718
y.create.l HWIO_MSS_CP_PILOT_SEED_ADDR A:0x420071c
y.create.l HWIO_MSS_CP_CODE_INDEX_ADDR A:0x4200720
y.create.l HWIO_MSS_CP_COEF1_ADDR A:0x4200724
y.create.l HWIO_MSS_CP_COEF2_ADDR A:0x4200728
y.create.l HWIO_MSS_CP_COEF3_ADDR A:0x420072c
y.create.l HWIO_MSS_CP_COEF4_ADDR A:0x4200730
y.create.l HWIO_MSS_CP_COEF5_ADDR A:0x4200734
y.create.l HWIO_MSS_CP_COEF6_ADDR A:0x4200738
y.create.l HWIO_MSS_CP_STATUS_ADDR A:0x420073c
y.create.l HWIO_MSS_CCP_BREAKPOINT_ADDR A:0x4200800
y.create.l HWIO_MSS_CCP_BREAK_STATE_ADDR A:0x4200804
y.create.l HWIO_MSS_CCP_PROG_STATUS_ADDR A:0x4200808
y.create.l HWIO_MSS_CCP_G10_STATUS_ADDR A:0x420080c
y.create.l HWIO_MSS_CCP_G32_STATUS_ADDR A:0x4200810
y.create.l HWIO_MSS_CCP_G54_STATUS_ADDR A:0x4200814
y.create.l HWIO_MSS_CCP_G76_STATUS_ADDR A:0x4200818
y.create.l HWIO_MSS_CCP_P10_STATUS_ADDR A:0x420081c
y.create.l HWIO_MSS_CCP_P2_STATUS_ADDR A:0x4200820
y.create.l HWIO_MSS_SM_ADDR_BEGIN_ADDR A:0x4240000
y.create.l HWIO_MSS_SM_ADDR_END_ADDR A:0x4256ffc
y.create.l HWIO_MSS_GPM_ADDR_BEGIN_ADDR A:0x4204000
y.create.l HWIO_MSS_GPM_ADDR_END_ADDR A:0x42047fc
y.create.l HWIO_MSS_GDM_ADDR_BEGIN_ADDR A:0x4208000
y.create.l HWIO_MSS_GDM_ADDR_END_ADDR A:0x42087fc
y.create.l HWIO_MSS_CMA_ADDR_BEGIN_ADDR A:0x420c000
y.create.l HWIO_MSS_CMA_ADDR_END_ADDR A:0x420edfc
y.create.l HWIO_MSS_CMB_ADDR_BEGIN_ADDR A:0x4210000
y.create.l HWIO_MSS_CMB_ADDR_END_ADDR A:0x4212dfc
y.create.l HWIO_MSS_VM_ADDR_BEGIN_ADDR A:0x4218000
y.create.l HWIO_MSS_VM_ADDR_END_ADDR A:0x4218ffc
y.create.l HWIO_MSS_PM_ADDR_BEGIN_ADDR A:0x421c000
y.create.l HWIO_MSS_PM_ADDR_END_ADDR A:0x421cffc
y.create.l HWIO_MSS_CCM_START_CMD_ADDR A:0x4214000
y.create.l HWIO_MSS_CCM_WORD1_CMD_ADDR A:0x4214004
y.create.l HWIO_MSS_CCM_WORD2_CMD_ADDR A:0x4214008
y.create.l HWIO_MSS_CCM_WORD3_CMD_ADDR A:0x421400c
y.create.l HWIO_MSS_CCM_WORD4_CMD_ADDR A:0x4214010
y.create.l HWIO_MSS_CCM_WORD5_CMD_ADDR A:0x4214014
y.create.l HWIO_MSS_CCM_WORD6_CMD_ADDR A:0x4214018
y.create.l HWIO_MSS_CCM_WORD7_CMD_ADDR A:0x421401c
y.create.l HWIO_MSS_CCM_END_CMD_ADDR A:0x4214020
y.create.l HWIO_MSS_CCM_STOP_CMD_ADDR A:0x42147dc
y.create.l HWIO_MSS_CCM_LOAD_CMD_ADDR A:0x42147e0
y.create.l HWIO_MSS_CCM_ERROR_CLEAR_CMD_ADDR A:0x42147e4
y.create.l HWIO_MSS_CCM_TIME_MARGIN_CMD_ADDR A:0x42147e8
y.create.l HWIO_MSS_CCM_LATE_TASK_ERROR_STATUS_ADDR A:0x42147ec
y.create.l HWIO_MSS_CCM_OVERRUN_ERROR_STATUS_ADDR A:0x42147f0
y.create.l HWIO_MSS_CCM_SEQ_NUMBER_STATUS_ADDR A:0x42147f4
y.create.l HWIO_MSS_CCM_DONE_RTC_STATUS_ADDR A:0x42147f8
y.create.l HWIO_MSS_CCM_STALL_COUNT_STATUS_ADDR A:0x42147fc
y.create.l HWIO_MSS_TPM_ADDR_BEGIN_ADDR A:0x4220000
y.create.l HWIO_MSS_TPM_ADDR_END_ADDR A:0x42201fc
y.create.l HWIO_MSS_TDM_ADDR_BEGIN_ADDR A:0x4224000
y.create.l HWIO_MSS_TDM_ADDR_END_ADDR A:0x42241fc
y.create.l HWIO_MSS_GACC_CLK_CTL_ADDR A:0x4200a00
y.create.l HWIO_MSS_GACC_RTC_WAIT_ADDR A:0x4200a04
y.create.l HWIO_MSS_GACC_START_ADDR_ADDR A:0x4200a08
y.create.l HWIO_MSS_GACC_COUNT_ADDR A:0x4200a0c
y.create.l HWIO_MSS_GACC_INCR_ADDR A:0x4200a10
y.create.l HWIO_MSS_GACC_FREQ_ADDR A:0x4200a14
y.create.l HWIO_MSS_GACC_CONFIG_ADDR A:0x4200a18
y.create.l HWIO_MSS_GACC_PEAK_ADDR A:0x4200a1c
y.create.l HWIO_MSS_GACC_DONE_ADDR A:0x4200a20
y.create.l HWIO_MSS_GACC_RTC_ADDR A:0x4200a24
y.create.l HWIO_MSS_GACC_TEST_BUS_OUT_ADDR A:0x4200a28
y.create.l HWIO_MSS_GACC_SAMPLE_MEM_START_ADDR_ADDR A:0x4228000
y.create.l HWIO_MSS_GACC_SAMPLE_MEM_END_ADDR_ADDR A:0x42289fc
y.create.l HWIO_MSS_GACC_ENERGY_MEM_START_ADDR_ADDR A:0x422c000
y.create.l HWIO_MSS_GACC_ENERGY_MEM_END_ADDR_ADDR A:0x422c9fc
y.create.l HWIO_MSS_HI0_CH0_CMD_PTR_SD0_ADDR A:0x4200b00
y.create.l HWIO_MSS_HI0_CH0_CMD_PTR_SD1_ADDR A:0x4200f00
y.create.l HWIO_MSS_HI0_CH0_CMD_PTR_SD2_ADDR A:0x4201300
y.create.l HWIO_MSS_HI0_CH0_CMD_PTR_SD3_ADDR A:0x4201700
y.create.l HWIO_MSS_HI0_CH1_CMD_PTR_SD0_ADDR A:0x4200b04
y.create.l HWIO_MSS_HI0_CH1_CMD_PTR_SD1_ADDR A:0x4200f04
y.create.l HWIO_MSS_HI0_CH1_CMD_PTR_SD2_ADDR A:0x4201304
y.create.l HWIO_MSS_HI0_CH1_CMD_PTR_SD3_ADDR A:0x4201704
y.create.l HWIO_MSS_HI0_CH2_CMD_PTR_SD0_ADDR A:0x4200b08
y.create.l HWIO_MSS_HI0_CH2_CMD_PTR_SD1_ADDR A:0x4200f08
y.create.l HWIO_MSS_HI0_CH2_CMD_PTR_SD2_ADDR A:0x4201308
y.create.l HWIO_MSS_HI0_CH2_CMD_PTR_SD3_ADDR A:0x4201708
y.create.l HWIO_MSS_HI0_CH3_CMD_PTR_SD0_ADDR A:0x4200b0c
y.create.l HWIO_MSS_HI0_CH3_CMD_PTR_SD1_ADDR A:0x4200f0c
y.create.l HWIO_MSS_HI0_CH3_CMD_PTR_SD2_ADDR A:0x420130c
y.create.l HWIO_MSS_HI0_CH3_CMD_PTR_SD3_ADDR A:0x420170c
y.create.l HWIO_MSS_HI0_CH4_CMD_PTR_SD0_ADDR A:0x4200b10
y.create.l HWIO_MSS_HI0_CH4_CMD_PTR_SD1_ADDR A:0x4200f10
y.create.l HWIO_MSS_HI0_CH4_CMD_PTR_SD2_ADDR A:0x4201310
y.create.l HWIO_MSS_HI0_CH4_CMD_PTR_SD3_ADDR A:0x4201710
y.create.l HWIO_MSS_HI0_CH5_CMD_PTR_SD0_ADDR A:0x4200b14
y.create.l HWIO_MSS_HI0_CH5_CMD_PTR_SD1_ADDR A:0x4200f14
y.create.l HWIO_MSS_HI0_CH5_CMD_PTR_SD2_ADDR A:0x4201314
y.create.l HWIO_MSS_HI0_CH5_CMD_PTR_SD3_ADDR A:0x4201714
y.create.l HWIO_MSS_HI0_CH6_CMD_PTR_SD0_ADDR A:0x4200b18
y.create.l HWIO_MSS_HI0_CH6_CMD_PTR_SD1_ADDR A:0x4200f18
y.create.l HWIO_MSS_HI0_CH6_CMD_PTR_SD2_ADDR A:0x4201318
y.create.l HWIO_MSS_HI0_CH6_CMD_PTR_SD3_ADDR A:0x4201718
y.create.l HWIO_MSS_HI0_CH7_CMD_PTR_SD0_ADDR A:0x4200b1c
y.create.l HWIO_MSS_HI0_CH7_CMD_PTR_SD1_ADDR A:0x4200f1c
y.create.l HWIO_MSS_HI0_CH7_CMD_PTR_SD2_ADDR A:0x420131c
y.create.l HWIO_MSS_HI0_CH7_CMD_PTR_SD3_ADDR A:0x420171c
y.create.l HWIO_MSS_HI0_CH0_RSLT_SD0_ADDR A:0x4200b40
y.create.l HWIO_MSS_HI0_CH0_RSLT_SD1_ADDR A:0x4200f40
y.create.l HWIO_MSS_HI0_CH0_RSLT_SD2_ADDR A:0x4201340
y.create.l HWIO_MSS_HI0_CH0_RSLT_SD3_ADDR A:0x4201740
y.create.l HWIO_MSS_HI0_CH1_RSLT_SD0_ADDR A:0x4200b44
y.create.l HWIO_MSS_HI0_CH1_RSLT_SD1_ADDR A:0x4200f44
y.create.l HWIO_MSS_HI0_CH1_RSLT_SD2_ADDR A:0x4201344
y.create.l HWIO_MSS_HI0_CH1_RSLT_SD3_ADDR A:0x4201744
y.create.l HWIO_MSS_HI0_CH2_RSLT_SD0_ADDR A:0x4200b48
y.create.l HWIO_MSS_HI0_CH2_RSLT_SD1_ADDR A:0x4200f48
y.create.l HWIO_MSS_HI0_CH2_RSLT_SD2_ADDR A:0x4201348
y.create.l HWIO_MSS_HI0_CH2_RSLT_SD3_ADDR A:0x4201748
y.create.l HWIO_MSS_HI0_CH3_RSLT_SD0_ADDR A:0x4200b4c
y.create.l HWIO_MSS_HI0_CH3_RSLT_SD1_ADDR A:0x4200f4c
y.create.l HWIO_MSS_HI0_CH3_RSLT_SD2_ADDR A:0x420134c
y.create.l HWIO_MSS_HI0_CH3_RSLT_SD3_ADDR A:0x420174c
y.create.l HWIO_MSS_HI0_CH4_RSLT_SD0_ADDR A:0x4200b50
y.create.l HWIO_MSS_HI0_CH4_RSLT_SD1_ADDR A:0x4200f50
y.create.l HWIO_MSS_HI0_CH4_RSLT_SD2_ADDR A:0x4201350
y.create.l HWIO_MSS_HI0_CH4_RSLT_SD3_ADDR A:0x4201750
y.create.l HWIO_MSS_HI0_CH5_RSLT_SD0_ADDR A:0x4200b54
y.create.l HWIO_MSS_HI0_CH5_RSLT_SD1_ADDR A:0x4200f54
y.create.l HWIO_MSS_HI0_CH5_RSLT_SD2_ADDR A:0x4201354
y.create.l HWIO_MSS_HI0_CH5_RSLT_SD3_ADDR A:0x4201754
y.create.l HWIO_MSS_HI0_CH6_RSLT_SD0_ADDR A:0x4200b58
y.create.l HWIO_MSS_HI0_CH6_RSLT_SD1_ADDR A:0x4200f58
y.create.l HWIO_MSS_HI0_CH6_RSLT_SD2_ADDR A:0x4201358
y.create.l HWIO_MSS_HI0_CH6_RSLT_SD3_ADDR A:0x4201758
y.create.l HWIO_MSS_HI0_CH7_RSLT_SD0_ADDR A:0x4200b5c
y.create.l HWIO_MSS_HI0_CH7_RSLT_SD1_ADDR A:0x4200f5c
y.create.l HWIO_MSS_HI0_CH7_RSLT_SD2_ADDR A:0x420135c
y.create.l HWIO_MSS_HI0_CH7_RSLT_SD3_ADDR A:0x420175c
y.create.l HWIO_MSS_HI0_CH0_FLUSH_STATE0_SD0_ADDR A:0x4200b80
y.create.l HWIO_MSS_HI0_CH0_FLUSH_STATE0_SD1_ADDR A:0x4200f80
y.create.l HWIO_MSS_HI0_CH0_FLUSH_STATE0_SD2_ADDR A:0x4201380
y.create.l HWIO_MSS_HI0_CH0_FLUSH_STATE0_SD3_ADDR A:0x4201780
y.create.l HWIO_MSS_HI0_CH1_FLUSH_STATE0_SD0_ADDR A:0x4200b84
y.create.l HWIO_MSS_HI0_CH1_FLUSH_STATE0_SD1_ADDR A:0x4200f84
y.create.l HWIO_MSS_HI0_CH1_FLUSH_STATE0_SD2_ADDR A:0x4201384
y.create.l HWIO_MSS_HI0_CH1_FLUSH_STATE0_SD3_ADDR A:0x4201784
y.create.l HWIO_MSS_HI0_CH2_FLUSH_STATE0_SD0_ADDR A:0x4200b88
y.create.l HWIO_MSS_HI0_CH2_FLUSH_STATE0_SD1_ADDR A:0x4200f88
y.create.l HWIO_MSS_HI0_CH2_FLUSH_STATE0_SD2_ADDR A:0x4201388
y.create.l HWIO_MSS_HI0_CH2_FLUSH_STATE0_SD3_ADDR A:0x4201788
y.create.l HWIO_MSS_HI0_CH3_FLUSH_STATE0_SD0_ADDR A:0x4200b8c
y.create.l HWIO_MSS_HI0_CH3_FLUSH_STATE0_SD1_ADDR A:0x4200f8c
y.create.l HWIO_MSS_HI0_CH3_FLUSH_STATE0_SD2_ADDR A:0x420138c
y.create.l HWIO_MSS_HI0_CH3_FLUSH_STATE0_SD3_ADDR A:0x420178c
y.create.l HWIO_MSS_HI0_CH4_FLUSH_STATE0_SD0_ADDR A:0x4200b90
y.create.l HWIO_MSS_HI0_CH4_FLUSH_STATE0_SD1_ADDR A:0x4200f90
y.create.l HWIO_MSS_HI0_CH4_FLUSH_STATE0_SD2_ADDR A:0x4201390
y.create.l HWIO_MSS_HI0_CH4_FLUSH_STATE0_SD3_ADDR A:0x4201790
y.create.l HWIO_MSS_HI0_CH5_FLUSH_STATE0_SD0_ADDR A:0x4200b94
y.create.l HWIO_MSS_HI0_CH5_FLUSH_STATE0_SD1_ADDR A:0x4200f94
y.create.l HWIO_MSS_HI0_CH5_FLUSH_STATE0_SD2_ADDR A:0x4201394
y.create.l HWIO_MSS_HI0_CH5_FLUSH_STATE0_SD3_ADDR A:0x4201794
y.create.l HWIO_MSS_HI0_CH6_FLUSH_STATE0_SD0_ADDR A:0x4200b98
y.create.l HWIO_MSS_HI0_CH6_FLUSH_STATE0_SD1_ADDR A:0x4200f98
y.create.l HWIO_MSS_HI0_CH6_FLUSH_STATE0_SD2_ADDR A:0x4201398
y.create.l HWIO_MSS_HI0_CH6_FLUSH_STATE0_SD3_ADDR A:0x4201798
y.create.l HWIO_MSS_HI0_CH7_FLUSH_STATE0_SD0_ADDR A:0x4200b9c
y.create.l HWIO_MSS_HI0_CH7_FLUSH_STATE0_SD1_ADDR A:0x4200f9c
y.create.l HWIO_MSS_HI0_CH7_FLUSH_STATE0_SD2_ADDR A:0x420139c
y.create.l HWIO_MSS_HI0_CH7_FLUSH_STATE0_SD3_ADDR A:0x420179c
y.create.l HWIO_MSS_HI0_CH0_FLUSH_STATE1_SD0_ADDR A:0x4200bc0
y.create.l HWIO_MSS_HI0_CH0_FLUSH_STATE1_SD1_ADDR A:0x4200fc0
y.create.l HWIO_MSS_HI0_CH0_FLUSH_STATE1_SD2_ADDR A:0x42013c0
y.create.l HWIO_MSS_HI0_CH0_FLUSH_STATE1_SD3_ADDR A:0x42017c0
y.create.l HWIO_MSS_HI0_CH1_FLUSH_STATE1_SD0_ADDR A:0x4200bc4
y.create.l HWIO_MSS_HI0_CH1_FLUSH_STATE1_SD1_ADDR A:0x4200fc4
y.create.l HWIO_MSS_HI0_CH1_FLUSH_STATE1_SD2_ADDR A:0x42013c4
y.create.l HWIO_MSS_HI0_CH1_FLUSH_STATE1_SD3_ADDR A:0x42017c4
y.create.l HWIO_MSS_HI0_CH2_FLUSH_STATE1_SD0_ADDR A:0x4200bc8
y.create.l HWIO_MSS_HI0_CH2_FLUSH_STATE1_SD1_ADDR A:0x4200fc8
y.create.l HWIO_MSS_HI0_CH2_FLUSH_STATE1_SD2_ADDR A:0x42013c8
y.create.l HWIO_MSS_HI0_CH2_FLUSH_STATE1_SD3_ADDR A:0x42017c8
y.create.l HWIO_MSS_HI0_CH3_FLUSH_STATE1_SD0_ADDR A:0x4200bcc
y.create.l HWIO_MSS_HI0_CH3_FLUSH_STATE1_SD1_ADDR A:0x4200fcc
y.create.l HWIO_MSS_HI0_CH3_FLUSH_STATE1_SD2_ADDR A:0x42013cc
y.create.l HWIO_MSS_HI0_CH3_FLUSH_STATE1_SD3_ADDR A:0x42017cc
y.create.l HWIO_MSS_HI0_CH4_FLUSH_STATE1_SD0_ADDR A:0x4200bd0
y.create.l HWIO_MSS_HI0_CH4_FLUSH_STATE1_SD1_ADDR A:0x4200fd0
y.create.l HWIO_MSS_HI0_CH4_FLUSH_STATE1_SD2_ADDR A:0x42013d0
y.create.l HWIO_MSS_HI0_CH4_FLUSH_STATE1_SD3_ADDR A:0x42017d0
y.create.l HWIO_MSS_HI0_CH5_FLUSH_STATE1_SD0_ADDR A:0x4200bd4
y.create.l HWIO_MSS_HI0_CH5_FLUSH_STATE1_SD1_ADDR A:0x4200fd4
y.create.l HWIO_MSS_HI0_CH5_FLUSH_STATE1_SD2_ADDR A:0x42013d4
y.create.l HWIO_MSS_HI0_CH5_FLUSH_STATE1_SD3_ADDR A:0x42017d4
y.create.l HWIO_MSS_HI0_CH6_FLUSH_STATE1_SD0_ADDR A:0x4200bd8
y.create.l HWIO_MSS_HI0_CH6_FLUSH_STATE1_SD1_ADDR A:0x4200fd8
y.create.l HWIO_MSS_HI0_CH6_FLUSH_STATE1_SD2_ADDR A:0x42013d8
y.create.l HWIO_MSS_HI0_CH6_FLUSH_STATE1_SD3_ADDR A:0x42017d8
y.create.l HWIO_MSS_HI0_CH7_FLUSH_STATE1_SD0_ADDR A:0x4200bdc
y.create.l HWIO_MSS_HI0_CH7_FLUSH_STATE1_SD1_ADDR A:0x4200fdc
y.create.l HWIO_MSS_HI0_CH7_FLUSH_STATE1_SD2_ADDR A:0x42013dc
y.create.l HWIO_MSS_HI0_CH7_FLUSH_STATE1_SD3_ADDR A:0x42017dc
y.create.l HWIO_MSS_HI0_CH0_FLUSH_STATE3_SD0_ADDR A:0x4200c40
y.create.l HWIO_MSS_HI0_CH0_FLUSH_STATE3_SD1_ADDR A:0x4201040
y.create.l HWIO_MSS_HI0_CH0_FLUSH_STATE3_SD2_ADDR A:0x4201440
y.create.l HWIO_MSS_HI0_CH0_FLUSH_STATE3_SD3_ADDR A:0x4201840
y.create.l HWIO_MSS_HI0_CH1_FLUSH_STATE3_SD0_ADDR A:0x4200c44
y.create.l HWIO_MSS_HI0_CH1_FLUSH_STATE3_SD1_ADDR A:0x4201044
y.create.l HWIO_MSS_HI0_CH1_FLUSH_STATE3_SD2_ADDR A:0x4201444
y.create.l HWIO_MSS_HI0_CH1_FLUSH_STATE3_SD3_ADDR A:0x4201844
y.create.l HWIO_MSS_HI0_CH2_FLUSH_STATE3_SD0_ADDR A:0x4200c48
y.create.l HWIO_MSS_HI0_CH2_FLUSH_STATE3_SD1_ADDR A:0x4201048
y.create.l HWIO_MSS_HI0_CH2_FLUSH_STATE3_SD2_ADDR A:0x4201448
y.create.l HWIO_MSS_HI0_CH2_FLUSH_STATE3_SD3_ADDR A:0x4201848
y.create.l HWIO_MSS_HI0_CH3_FLUSH_STATE3_SD0_ADDR A:0x4200c4c
y.create.l HWIO_MSS_HI0_CH3_FLUSH_STATE3_SD1_ADDR A:0x420104c
y.create.l HWIO_MSS_HI0_CH3_FLUSH_STATE3_SD2_ADDR A:0x420144c
y.create.l HWIO_MSS_HI0_CH3_FLUSH_STATE3_SD3_ADDR A:0x420184c
y.create.l HWIO_MSS_HI0_CH4_FLUSH_STATE3_SD0_ADDR A:0x4200c50
y.create.l HWIO_MSS_HI0_CH4_FLUSH_STATE3_SD1_ADDR A:0x4201050
y.create.l HWIO_MSS_HI0_CH4_FLUSH_STATE3_SD2_ADDR A:0x4201450
y.create.l HWIO_MSS_HI0_CH4_FLUSH_STATE3_SD3_ADDR A:0x4201850
y.create.l HWIO_MSS_HI0_CH5_FLUSH_STATE3_SD0_ADDR A:0x4200c54
y.create.l HWIO_MSS_HI0_CH5_FLUSH_STATE3_SD1_ADDR A:0x4201054
y.create.l HWIO_MSS_HI0_CH5_FLUSH_STATE3_SD2_ADDR A:0x4201454
y.create.l HWIO_MSS_HI0_CH5_FLUSH_STATE3_SD3_ADDR A:0x4201854
y.create.l HWIO_MSS_HI0_CH6_FLUSH_STATE3_SD0_ADDR A:0x4200c58
y.create.l HWIO_MSS_HI0_CH6_FLUSH_STATE3_SD1_ADDR A:0x4201058
y.create.l HWIO_MSS_HI0_CH6_FLUSH_STATE3_SD2_ADDR A:0x4201458
y.create.l HWIO_MSS_HI0_CH6_FLUSH_STATE3_SD3_ADDR A:0x4201858
y.create.l HWIO_MSS_HI0_CH7_FLUSH_STATE3_SD0_ADDR A:0x4200c5c
y.create.l HWIO_MSS_HI0_CH7_FLUSH_STATE3_SD1_ADDR A:0x420105c
y.create.l HWIO_MSS_HI0_CH7_FLUSH_STATE3_SD2_ADDR A:0x420145c
y.create.l HWIO_MSS_HI0_CH7_FLUSH_STATE3_SD3_ADDR A:0x420185c
y.create.l HWIO_MSS_HI0_CH0_FLUSH_STATE4_SD0_ADDR A:0x4200c80
y.create.l HWIO_MSS_HI0_CH0_FLUSH_STATE4_SD1_ADDR A:0x4201080
y.create.l HWIO_MSS_HI0_CH0_FLUSH_STATE4_SD2_ADDR A:0x4201480
y.create.l HWIO_MSS_HI0_CH0_FLUSH_STATE4_SD3_ADDR A:0x4201880
y.create.l HWIO_MSS_HI0_CH1_FLUSH_STATE4_SD0_ADDR A:0x4200c84
y.create.l HWIO_MSS_HI0_CH1_FLUSH_STATE4_SD1_ADDR A:0x4201084
y.create.l HWIO_MSS_HI0_CH1_FLUSH_STATE4_SD2_ADDR A:0x4201484
y.create.l HWIO_MSS_HI0_CH1_FLUSH_STATE4_SD3_ADDR A:0x4201884
y.create.l HWIO_MSS_HI0_CH2_FLUSH_STATE4_SD0_ADDR A:0x4200c88
y.create.l HWIO_MSS_HI0_CH2_FLUSH_STATE4_SD1_ADDR A:0x4201088
y.create.l HWIO_MSS_HI0_CH2_FLUSH_STATE4_SD2_ADDR A:0x4201488
y.create.l HWIO_MSS_HI0_CH2_FLUSH_STATE4_SD3_ADDR A:0x4201888
y.create.l HWIO_MSS_HI0_CH3_FLUSH_STATE4_SD0_ADDR A:0x4200c8c
y.create.l HWIO_MSS_HI0_CH3_FLUSH_STATE4_SD1_ADDR A:0x420108c
y.create.l HWIO_MSS_HI0_CH3_FLUSH_STATE4_SD2_ADDR A:0x420148c
y.create.l HWIO_MSS_HI0_CH3_FLUSH_STATE4_SD3_ADDR A:0x420188c
y.create.l HWIO_MSS_HI0_CH4_FLUSH_STATE4_SD0_ADDR A:0x4200c90
y.create.l HWIO_MSS_HI0_CH4_FLUSH_STATE4_SD1_ADDR A:0x4201090
y.create.l HWIO_MSS_HI0_CH4_FLUSH_STATE4_SD2_ADDR A:0x4201490
y.create.l HWIO_MSS_HI0_CH4_FLUSH_STATE4_SD3_ADDR A:0x4201890
y.create.l HWIO_MSS_HI0_CH5_FLUSH_STATE4_SD0_ADDR A:0x4200c94
y.create.l HWIO_MSS_HI0_CH5_FLUSH_STATE4_SD1_ADDR A:0x4201094
y.create.l HWIO_MSS_HI0_CH5_FLUSH_STATE4_SD2_ADDR A:0x4201494
y.create.l HWIO_MSS_HI0_CH5_FLUSH_STATE4_SD3_ADDR A:0x4201894
y.create.l HWIO_MSS_HI0_CH6_FLUSH_STATE4_SD0_ADDR A:0x4200c98
y.create.l HWIO_MSS_HI0_CH6_FLUSH_STATE4_SD1_ADDR A:0x4201098
y.create.l HWIO_MSS_HI0_CH6_FLUSH_STATE4_SD2_ADDR A:0x4201498
y.create.l HWIO_MSS_HI0_CH6_FLUSH_STATE4_SD3_ADDR A:0x4201898
y.create.l HWIO_MSS_HI0_CH7_FLUSH_STATE4_SD0_ADDR A:0x4200c9c
y.create.l HWIO_MSS_HI0_CH7_FLUSH_STATE4_SD1_ADDR A:0x420109c
y.create.l HWIO_MSS_HI0_CH7_FLUSH_STATE4_SD2_ADDR A:0x420149c
y.create.l HWIO_MSS_HI0_CH7_FLUSH_STATE4_SD3_ADDR A:0x420189c
y.create.l HWIO_MSS_HI0_CH0_FLUSH_STATE5_SD0_ADDR A:0x4200cc0
y.create.l HWIO_MSS_HI0_CH0_FLUSH_STATE5_SD1_ADDR A:0x42010c0
y.create.l HWIO_MSS_HI0_CH0_FLUSH_STATE5_SD2_ADDR A:0x42014c0
y.create.l HWIO_MSS_HI0_CH0_FLUSH_STATE5_SD3_ADDR A:0x42018c0
y.create.l HWIO_MSS_HI0_CH1_FLUSH_STATE5_SD0_ADDR A:0x4200cc4
y.create.l HWIO_MSS_HI0_CH1_FLUSH_STATE5_SD1_ADDR A:0x42010c4
y.create.l HWIO_MSS_HI0_CH1_FLUSH_STATE5_SD2_ADDR A:0x42014c4
y.create.l HWIO_MSS_HI0_CH1_FLUSH_STATE5_SD3_ADDR A:0x42018c4
y.create.l HWIO_MSS_HI0_CH2_FLUSH_STATE5_SD0_ADDR A:0x4200cc8
y.create.l HWIO_MSS_HI0_CH2_FLUSH_STATE5_SD1_ADDR A:0x42010c8
y.create.l HWIO_MSS_HI0_CH2_FLUSH_STATE5_SD2_ADDR A:0x42014c8
y.create.l HWIO_MSS_HI0_CH2_FLUSH_STATE5_SD3_ADDR A:0x42018c8
y.create.l HWIO_MSS_HI0_CH3_FLUSH_STATE5_SD0_ADDR A:0x4200ccc
y.create.l HWIO_MSS_HI0_CH3_FLUSH_STATE5_SD1_ADDR A:0x42010cc
y.create.l HWIO_MSS_HI0_CH3_FLUSH_STATE5_SD2_ADDR A:0x42014cc
y.create.l HWIO_MSS_HI0_CH3_FLUSH_STATE5_SD3_ADDR A:0x42018cc
y.create.l HWIO_MSS_HI0_CH4_FLUSH_STATE5_SD0_ADDR A:0x4200cd0
y.create.l HWIO_MSS_HI0_CH4_FLUSH_STATE5_SD1_ADDR A:0x42010d0
y.create.l HWIO_MSS_HI0_CH4_FLUSH_STATE5_SD2_ADDR A:0x42014d0
y.create.l HWIO_MSS_HI0_CH4_FLUSH_STATE5_SD3_ADDR A:0x42018d0
y.create.l HWIO_MSS_HI0_CH5_FLUSH_STATE5_SD0_ADDR A:0x4200cd4
y.create.l HWIO_MSS_HI0_CH5_FLUSH_STATE5_SD1_ADDR A:0x42010d4
y.create.l HWIO_MSS_HI0_CH5_FLUSH_STATE5_SD2_ADDR A:0x42014d4
y.create.l HWIO_MSS_HI0_CH5_FLUSH_STATE5_SD3_ADDR A:0x42018d4
y.create.l HWIO_MSS_HI0_CH6_FLUSH_STATE5_SD0_ADDR A:0x4200cd8
y.create.l HWIO_MSS_HI0_CH6_FLUSH_STATE5_SD1_ADDR A:0x42010d8
y.create.l HWIO_MSS_HI0_CH6_FLUSH_STATE5_SD2_ADDR A:0x42014d8
y.create.l HWIO_MSS_HI0_CH6_FLUSH_STATE5_SD3_ADDR A:0x42018d8
y.create.l HWIO_MSS_HI0_CH7_FLUSH_STATE5_SD0_ADDR A:0x4200cdc
y.create.l HWIO_MSS_HI0_CH7_FLUSH_STATE5_SD1_ADDR A:0x42010dc
y.create.l HWIO_MSS_HI0_CH7_FLUSH_STATE5_SD2_ADDR A:0x42014dc
y.create.l HWIO_MSS_HI0_CH7_FLUSH_STATE5_SD3_ADDR A:0x42018dc
y.create.l HWIO_MSS_HI0_SEC_DOMAIN_IRQ_STATUS_SD0_ADDR A:0x4200e80
y.create.l HWIO_MSS_HI0_SEC_DOMAIN_IRQ_STATUS_SD1_ADDR A:0x4201280
y.create.l HWIO_MSS_HI0_SEC_DOMAIN_IRQ_STATUS_SD2_ADDR A:0x4201680
y.create.l HWIO_MSS_HI0_SEC_DOMAIN_IRQ_STATUS_SD3_ADDR A:0x4201a80
y.create.l HWIO_MSS_HI0_CH0_RSLT_CONF_SD0_ADDR A:0x4200e00
y.create.l HWIO_MSS_HI0_CH0_RSLT_CONF_SD1_ADDR A:0x4201200
y.create.l HWIO_MSS_HI0_CH0_RSLT_CONF_SD2_ADDR A:0x4201600
y.create.l HWIO_MSS_HI0_CH0_RSLT_CONF_SD3_ADDR A:0x4201a00
y.create.l HWIO_MSS_HI0_CH1_RSLT_CONF_SD0_ADDR A:0x4200e04
y.create.l HWIO_MSS_HI0_CH1_RSLT_CONF_SD1_ADDR A:0x4201204
y.create.l HWIO_MSS_HI0_CH1_RSLT_CONF_SD2_ADDR A:0x4201604
y.create.l HWIO_MSS_HI0_CH1_RSLT_CONF_SD3_ADDR A:0x4201a04
y.create.l HWIO_MSS_HI0_CH2_RSLT_CONF_SD0_ADDR A:0x4200e08
y.create.l HWIO_MSS_HI0_CH2_RSLT_CONF_SD1_ADDR A:0x4201208
y.create.l HWIO_MSS_HI0_CH2_RSLT_CONF_SD2_ADDR A:0x4201608
y.create.l HWIO_MSS_HI0_CH2_RSLT_CONF_SD3_ADDR A:0x4201a08
y.create.l HWIO_MSS_HI0_CH3_RSLT_CONF_SD0_ADDR A:0x4200e0c
y.create.l HWIO_MSS_HI0_CH3_RSLT_CONF_SD1_ADDR A:0x420120c
y.create.l HWIO_MSS_HI0_CH3_RSLT_CONF_SD2_ADDR A:0x420160c
y.create.l HWIO_MSS_HI0_CH3_RSLT_CONF_SD3_ADDR A:0x4201a0c
y.create.l HWIO_MSS_HI0_CH4_RSLT_CONF_SD0_ADDR A:0x4200e10
y.create.l HWIO_MSS_HI0_CH4_RSLT_CONF_SD1_ADDR A:0x4201210
y.create.l HWIO_MSS_HI0_CH4_RSLT_CONF_SD2_ADDR A:0x4201610
y.create.l HWIO_MSS_HI0_CH4_RSLT_CONF_SD3_ADDR A:0x4201a10
y.create.l HWIO_MSS_HI0_CH5_RSLT_CONF_SD0_ADDR A:0x4200e14
y.create.l HWIO_MSS_HI0_CH5_RSLT_CONF_SD1_ADDR A:0x4201214
y.create.l HWIO_MSS_HI0_CH5_RSLT_CONF_SD2_ADDR A:0x4201614
y.create.l HWIO_MSS_HI0_CH5_RSLT_CONF_SD3_ADDR A:0x4201a14
y.create.l HWIO_MSS_HI0_CH6_RSLT_CONF_SD0_ADDR A:0x4200e18
y.create.l HWIO_MSS_HI0_CH6_RSLT_CONF_SD1_ADDR A:0x4201218
y.create.l HWIO_MSS_HI0_CH6_RSLT_CONF_SD2_ADDR A:0x4201618
y.create.l HWIO_MSS_HI0_CH6_RSLT_CONF_SD3_ADDR A:0x4201a18
y.create.l HWIO_MSS_HI0_CH7_RSLT_CONF_SD0_ADDR A:0x4200e1c
y.create.l HWIO_MSS_HI0_CH7_RSLT_CONF_SD1_ADDR A:0x420121c
y.create.l HWIO_MSS_HI0_CH7_RSLT_CONF_SD2_ADDR A:0x420161c
y.create.l HWIO_MSS_HI0_CH7_RSLT_CONF_SD3_ADDR A:0x4201a1c
y.create.l HWIO_MSS_HI0_CH0_STATUS_SD0_ADDR A:0x4200d00
y.create.l HWIO_MSS_HI0_CH0_STATUS_SD1_ADDR A:0x4201100
y.create.l HWIO_MSS_HI0_CH0_STATUS_SD2_ADDR A:0x4201500
y.create.l HWIO_MSS_HI0_CH0_STATUS_SD3_ADDR A:0x4201900
y.create.l HWIO_MSS_HI0_CH1_STATUS_SD0_ADDR A:0x4200d04
y.create.l HWIO_MSS_HI0_CH1_STATUS_SD1_ADDR A:0x4201104
y.create.l HWIO_MSS_HI0_CH1_STATUS_SD2_ADDR A:0x4201504
y.create.l HWIO_MSS_HI0_CH1_STATUS_SD3_ADDR A:0x4201904
y.create.l HWIO_MSS_HI0_CH2_STATUS_SD0_ADDR A:0x4200d08
y.create.l HWIO_MSS_HI0_CH2_STATUS_SD1_ADDR A:0x4201108
y.create.l HWIO_MSS_HI0_CH2_STATUS_SD2_ADDR A:0x4201508
y.create.l HWIO_MSS_HI0_CH2_STATUS_SD3_ADDR A:0x4201908
y.create.l HWIO_MSS_HI0_CH3_STATUS_SD0_ADDR A:0x4200d0c
y.create.l HWIO_MSS_HI0_CH3_STATUS_SD1_ADDR A:0x420110c
y.create.l HWIO_MSS_HI0_CH3_STATUS_SD2_ADDR A:0x420150c
y.create.l HWIO_MSS_HI0_CH3_STATUS_SD3_ADDR A:0x420190c
y.create.l HWIO_MSS_HI0_CH4_STATUS_SD0_ADDR A:0x4200d10
y.create.l HWIO_MSS_HI0_CH4_STATUS_SD1_ADDR A:0x4201110
y.create.l HWIO_MSS_HI0_CH4_STATUS_SD2_ADDR A:0x4201510
y.create.l HWIO_MSS_HI0_CH4_STATUS_SD3_ADDR A:0x4201910
y.create.l HWIO_MSS_HI0_CH5_STATUS_SD0_ADDR A:0x4200d14
y.create.l HWIO_MSS_HI0_CH5_STATUS_SD1_ADDR A:0x4201114
y.create.l HWIO_MSS_HI0_CH5_STATUS_SD2_ADDR A:0x4201514
y.create.l HWIO_MSS_HI0_CH5_STATUS_SD3_ADDR A:0x4201914
y.create.l HWIO_MSS_HI0_CH6_STATUS_SD0_ADDR A:0x4200d18
y.create.l HWIO_MSS_HI0_CH6_STATUS_SD1_ADDR A:0x4201118
y.create.l HWIO_MSS_HI0_CH6_STATUS_SD2_ADDR A:0x4201518
y.create.l HWIO_MSS_HI0_CH6_STATUS_SD3_ADDR A:0x4201918
y.create.l HWIO_MSS_HI0_CH7_STATUS_SD0_ADDR A:0x4200d1c
y.create.l HWIO_MSS_HI0_CH7_STATUS_SD1_ADDR A:0x420111c
y.create.l HWIO_MSS_HI0_CH7_STATUS_SD2_ADDR A:0x420151c
y.create.l HWIO_MSS_HI0_CH7_STATUS_SD3_ADDR A:0x420191c
y.create.l HWIO_MSS_HI0_CH0_CONF_ADDR A:0x4200d40
y.create.l HWIO_MSS_HI0_CH1_CONF_ADDR A:0x4200d44
y.create.l HWIO_MSS_HI0_CH2_CONF_ADDR A:0x4200d48
y.create.l HWIO_MSS_HI0_CH3_CONF_ADDR A:0x4200d4c
y.create.l HWIO_MSS_HI0_CH4_CONF_ADDR A:0x4200d50
y.create.l HWIO_MSS_HI0_CH5_CONF_ADDR A:0x4200d54
y.create.l HWIO_MSS_HI0_CH6_CONF_ADDR A:0x4200d58
y.create.l HWIO_MSS_HI0_CH7_CONF_ADDR A:0x4200d5c
y.create.l HWIO_MSS_HI0_CH0_DBG_0_ADDR A:0x4200d80
y.create.l HWIO_MSS_HI0_CH1_DBG_0_ADDR A:0x4200d84
y.create.l HWIO_MSS_HI0_CH2_DBG_0_ADDR A:0x4200d88
y.create.l HWIO_MSS_HI0_CH3_DBG_0_ADDR A:0x4200d8c
y.create.l HWIO_MSS_HI0_CH4_DBG_0_ADDR A:0x4200d90
y.create.l HWIO_MSS_HI0_CH5_DBG_0_ADDR A:0x4200d94
y.create.l HWIO_MSS_HI0_CH6_DBG_0_ADDR A:0x4200d98
y.create.l HWIO_MSS_HI0_CH7_DBG_0_ADDR A:0x4200d9c
y.create.l HWIO_MSS_HI0_CH0_DBG_1_ADDR A:0x4200dc0
y.create.l HWIO_MSS_HI0_CH1_DBG_1_ADDR A:0x4200dc4
y.create.l HWIO_MSS_HI0_CH2_DBG_1_ADDR A:0x4200dc8
y.create.l HWIO_MSS_HI0_CH3_DBG_1_ADDR A:0x4200dcc
y.create.l HWIO_MSS_HI0_CH4_DBG_1_ADDR A:0x4200dd0
y.create.l HWIO_MSS_HI0_CH5_DBG_1_ADDR A:0x4200dd4
y.create.l HWIO_MSS_HI0_CH6_DBG_1_ADDR A:0x4200dd8
y.create.l HWIO_MSS_HI0_CH7_DBG_1_ADDR A:0x4200ddc
y.create.l HWIO_MSS_HI0_CI0_CONF_ADDR A:0x4200e90
y.create.l HWIO_MSS_HI0_CI1_CONF_ADDR A:0x4200e94
y.create.l HWIO_MSS_HI0_CI2_CONF_ADDR A:0x4200e98
y.create.l HWIO_MSS_HI0_CI3_CONF_ADDR A:0x4200e9c
y.create.l HWIO_MSS_HI0_CI4_CONF_ADDR A:0x4200ea0
y.create.l HWIO_MSS_HI0_CI5_CONF_ADDR A:0x4200ea4
y.create.l HWIO_MSS_HI0_CI6_CONF_ADDR A:0x4200ea8
y.create.l HWIO_MSS_HI0_CI7_CONF_ADDR A:0x4200eac
y.create.l HWIO_MSS_HI0_CI0_DBG_ERR_ADDR A:0x4200eb0
y.create.l HWIO_MSS_HI0_CI1_DBG_ERR_ADDR A:0x4200eb4
y.create.l HWIO_MSS_HI0_CI2_DBG_ERR_ADDR A:0x4200eb8
y.create.l HWIO_MSS_HI0_CI3_DBG_ERR_ADDR A:0x4200ebc
y.create.l HWIO_MSS_HI0_CI4_DBG_ERR_ADDR A:0x4200ec0
y.create.l HWIO_MSS_HI0_CI5_DBG_ERR_ADDR A:0x4200ec4
y.create.l HWIO_MSS_HI0_CI6_DBG_ERR_ADDR A:0x4200ec8
y.create.l HWIO_MSS_HI0_CI7_DBG_ERR_ADDR A:0x4200ecc
y.create.l HWIO_MSS_HI0_CRCI_DBG_ADDR A:0x4200ed0
y.create.l HWIO_MSS_HI0_CRCI_STATUS_ADDR A:0x4200ed4
y.create.l HWIO_MSS_HI0_GP_CTL_ADDR A:0x4200ed8
y.create.l HWIO_MSS_HI0_GP_STATUS_ADDR A:0x4200edc
y.create.l HWIO_MSS_HI0_GLBL_DBG_CMD_ENG_ADDR A:0x4200ee0
y.create.l HWIO_MSS_HI0_GLBL_DBG_REQ_ENG_ADDR A:0x4200ee4
y.create.l HWIO_MSS_HI0_GLBL_DBG_XFR_ENG_ADDR A:0x4200ee8
y.create.l HWIO_MSS_HI0_GLBL_DBG_CHAN_BLK_ADDR A:0x4200eec
y.create.l HWIO_MSS_HI0_GLBL_DBG_CHAN_BLK_CLR_ADDR A:0x4200ef0
y.create.l HWIO_MSS_HI0_GLBL_DBG_TEST_SEL_ADDR A:0x4200ef4
y.create.l HWIO_MSS_NAV_AHB_BUP_CONFIG_ADDR A:0x42001c0
y.create.l HWIO_MSS_NAV_AHB_BUP_STATUS_ADDR A:0x42001c4
y.create.l HWIO_MSS_NAV_AHB_BUP_STATUS1_ADDR A:0x42001c8
y.create.l HWIO_MSS_NAV_AHB_BUP_STATUS2_ADDR A:0x42001cc
y.create.l HWIO_MSS_NAV_AHB_BUP_STATUS3_ADDR A:0x42001d0
y.create.l HWIO_MSS_NAV_AHB_BUP_STATUS4_ADDR A:0x42001d4
y.create.l HWIO_MSS_NAV_AHB_BUP_STATUS5_ADDR A:0x42001d8
y.create.l HWIO_MSS_NAV_AHB_BUP_STATUS6_ADDR A:0x42001dc
y.create.l HWIO_MSS_NAV_AHB_BUP_STATUS7_ADDR A:0x42001e0
y.create.l HWIO_MSS_NAV_CLK_ENABLE_ADDR A:0x42f8000
y.create.l HWIO_MSS_NAV_CLK_RESET_ADDR A:0x42f8004
y.create.l HWIO_MSS_NAV_CLK_CTL_ADDR A:0x42f8008
y.create.l HWIO_MSS_NAV_CLK_FRAC31_M_ADDR A:0x42f800c
y.create.l HWIO_MSS_NAV_CLK_FRAC31_NOT_2D_ADDR A:0x42f8010
y.create.l HWIO_MSS_NAV_CLK_FRAC31_NOT_N_MINUS_M_ADDR A:0x42f8014
y.create.l HWIO_MSS_NAV_CLK_FRAC31_UPDATE_ADDR A:0x42f8018
y.create.l HWIO_MSS_NAV_CLK_GDS_ADDR A:0x42f801c
y.create.l HWIO_MSS_NAV_CLK_IPCAT_ADDR A:0x42f8020
y.create.l HWIO_MSS_NAV_CLK_AXI_BRIDGE_STATUS_ADDR A:0x42f8024
y.create.l HWIO_MSS_GNSS_ADC_CMD0_ADDR A:0x42f0000
y.create.l HWIO_MSS_GNSS_ADC_CMD1_ADDR A:0x42f0004
y.create.l HWIO_MSS_GNSS_ADC_CMD2_ADDR A:0x42f0008
y.create.l HWIO_MSS_GNSS_ADC_CMD3_ADDR A:0x42f000c
y.create.l HWIO_MSS_GNSS_ADC_IDDQ_ADDR A:0x42f0010
y.create.l HWIO_MSS_NAV_PLL4_PLLMODE_ADDR A:0x42f8800
y.create.l HWIO_MSS_NAV_PLL4_L_VAL_ADDR A:0x42f8804
y.create.l HWIO_MSS_NAV_PLL4_ALPHA_VAL_L_ADDR A:0x42f8808
y.create.l HWIO_MSS_NAV_PLL4_ALPHA_VAL_H_ADDR A:0x42f880c
y.create.l HWIO_MSS_NAV_PLL4_USER_CTL_ADDR A:0x42f8810
y.create.l HWIO_MSS_NAV_PLL4_USER_CTL_H_ADDR A:0x42f8814
y.create.l HWIO_MSS_NAV_PLL4_CONFIG_CTL_ADDR A:0x42f8818
y.create.l HWIO_MSS_NAV_PLL4_TEST_CTL_ADDR A:0x42f881c
y.create.l HWIO_MSS_NAV_PLL4_STATUS_ADDR A:0x42f8824
y.create.l HWIO_MSS_STMR_STATUS0_RD_ADDR A:0x42000c0
y.create.l HWIO_MSS_STMR_STATUS1_RD_ADDR A:0x42000c4
y.create.l HWIO_MSS_STMR_STATUS2_RD_ADDR A:0x42000c8
y.create.l HWIO_MSS_STMR_STATUS3_RD_ADDR A:0x42000cc
y.create.l HWIO_MSS_STMR_STATUS4_RD_ADDR A:0x42000d0
y.create.l HWIO_MSS_STMR_STATUS5_RD_ADDR A:0x42000d4
y.create.l HWIO_MSS_STMR_STATUS6_RD_ADDR A:0x42000d8
y.create.l HWIO_MSS_STMR_STATUS7_RD_ADDR A:0x42000dc
y.create.l HWIO_MSS_STMR_STATUS8_RD_ADDR A:0x42000e0
y.create.l HWIO_MSS_STMR_STATUS9_RD_ADDR A:0x42000e4
y.create.l HWIO_MSS_STMR_STATUS10_RD_ADDR A:0x42000e8
y.create.l HWIO_MSS_STMR_STATUS11_RD_ADDR A:0x42000ec
y.create.l HWIO_TX_ENABLE_ADDR A:0x4380000
y.create.l HWIO_TX_MEM_ACCESS_CFG_ADDR A:0x4380004
y.create.l HWIO_TX_MEM_PAGE_ADDR A:0x4380008
y.create.l HWIO_TX_AXI_WR_INTF_EVENT_ADDR A:0x438000c
y.create.l HWIO_TX_STMR_TRIG_FRAC_CNT_0_ADDR A:0x4380010
y.create.l HWIO_TX_FRAME_STB_FRAC_CNT_0_ADDR A:0x4380018
y.create.l HWIO_TX_MISR_CTRL_ADDR A:0x4380020
y.create.l HWIO_TX_MISR_RD_DATA_ADDR A:0x4380024
y.create.l HWIO_TX_MISR_CAP_EN_ADDR A:0x4380028
y.create.l HWIO_HARQ_DONE_STATUS_ADDR A:0x438002c
y.create.l HWIO_TX_MODE_0_ADDR A:0x4380030
y.create.l HWIO_TX_MODE_COMMON_ADDR A:0x4380038
y.create.l HWIO_TX_ENABLE_GSM_0_ADDR A:0x438003c
y.create.l HWIO_TX_TDS_CTRL_ADDR A:0x4380044
y.create.l HWIO_TX_MEM_TEST_WR_ADDR_ADDR A:0x4380048
y.create.l HWIO_TX_MEM_TEST_WR_ADDR_STATUS_ADDR A:0x438004c
y.create.l HWIO_TX_MEM_TEST_RD_ADDR A:0x4380050
y.create.l HWIO_TX_MEM_TEST_RD_ADDR_ADDR A:0x4380054
y.create.l HWIO_TX_MEM_TEST_RD_ADDR_STATUS_ADDR A:0x4380058
y.create.l HWIO_TX_SW_AHB_EVENT_ADDR0_ADDR A:0x4380060
y.create.l HWIO_TX_SW_AHB_EVENT_ADDR1_ADDR A:0x4380064
y.create.l HWIO_TX_SW_AHB_EVENT_ADDR2_ADDR A:0x4380068
y.create.l HWIO_TX_SW_AHB_EVENT_ADDR3_ADDR A:0x438006c
y.create.l HWIO_TX_SW_AHB_EVENT_ADDR4_ADDR A:0x4380070
y.create.l HWIO_TX_SW_AHB_EVENT_ADDR5_ADDR A:0x4380074
y.create.l HWIO_TX_SW_AHB_EVENT_ADDR6_ADDR A:0x4380078
y.create.l HWIO_TX_SW_AHB_EVENT_ADDR7_ADDR A:0x438007c
y.create.l HWIO_TX_A2_AHB_EVENT_ADDR_ADDR A:0x4380080
y.create.l HWIO_TX_EVENT_LOG_EN_ADDR A:0x4380084
y.create.l HWIO_TX_EVENT_SEL_0_ADDR A:0x4380088
y.create.l HWIO_TX_EVENT_SEL_1_ADDR A:0x438008c
y.create.l HWIO_TX_TESTBUS_SEL_ADDR A:0x4380090
y.create.l HWIO_TX_TESTBUS_RD_DATA_ADDR A:0x4380094
y.create.l HWIO_TX_TESTBUS_RD_DATA_MASK_ADDR A:0x4380098
y.create.l HWIO_TX_ERROR_IRQ_EN_ADDR A:0x438009c
y.create.l HWIO_TX_ERROR_IRQ_CLEAR_ADDR A:0x43800a0
y.create.l HWIO_TX_ERROR_IRQ_STATUS_ADDR A:0x43800a4
y.create.l HWIO_TX_STATUS_RD_ADDR A:0x43800a8
y.create.l HWIO_TX_DEBUG_IRQ_EN_ADDR A:0x43800ac
y.create.l HWIO_TX_DEBUG_IRQ_CLEAR_ADDR A:0x43800b0
y.create.l HWIO_TX_DEBUG_IRQ_STATUS_ADDR A:0x43800b4
y.create.l HWIO_TX_MODE_OFDMA_ADDR A:0x43800bc
y.create.l HWIO_TX_AXI_RD0_INTF_CTL_ADDR A:0x43800c8
y.create.l HWIO_TX_AXI_RD0_INTF_EVENT_ADDR A:0x43800cc
y.create.l HWIO_TX_SW_RESET_ENC_MOD_ADDR A:0x43800e0
y.create.l HWIO_TX_SW_RESET_TXC_TXR_0_ADDR A:0x43800e4
y.create.l HWIO_TX_ENC_CLK_INIT_ADDR A:0x43800ec
y.create.l HWIO_TX_C2K_MODE_ADDR A:0x4381000
y.create.l HWIO_TX_TDS_NEW_FRAME_SW_ADDR A:0x4381064
y.create.l HWIO_TX_UNIFIED_DCH_RACH_ENC_TRIGGER_ADDR A:0x4381068
y.create.l HWIO_TX_TDS_ERUCCH_ENC_TRIGGER_ADDR A:0x438106c
y.create.l HWIO_TX_1X_ENC_TRIGGER_ADDR A:0x4381070
y.create.l HWIO_TX_DO_ENC_TRIGGER_ADDR A:0x4381074
y.create.l HWIO_TX_DO_CARRIER_CONFIG_ADDR A:0x4381078
y.create.l HWIO_TX_UNIFIED_ENC_NUM_ACTIVE_TRCHS_ADDR A:0x438107c
y.create.l HWIO_TX_UNIFIED_ENC_ENDIAN_FRMT_CTL_ADDR A:0x4381080
y.create.l HWIO_TX_UNIFIED_ENC_CIPHER_CK0_0_ADDR A:0x4381084
y.create.l HWIO_TX_UNIFIED_ENC_CIPHER_CK0_1_ADDR A:0x4381088
y.create.l HWIO_TX_UNIFIED_ENC_CIPHER_CK0_2_ADDR A:0x438108c
y.create.l HWIO_TX_UNIFIED_ENC_CIPHER_CK0_3_ADDR A:0x4381090
y.create.l HWIO_TX_UNIFIED_ENC_CIPHER_CK1_0_ADDR A:0x4381094
y.create.l HWIO_TX_UNIFIED_ENC_CIPHER_CK1_1_ADDR A:0x4381098
y.create.l HWIO_TX_UNIFIED_ENC_CIPHER_CK1_2_ADDR A:0x438109c
y.create.l HWIO_TX_UNIFIED_ENC_CIPHER_CK1_3_ADDR A:0x43810a0
y.create.l HWIO_TX_UNIFIED_ENC_CIPHER_CK2_0_ADDR A:0x43810a4
y.create.l HWIO_TX_UNIFIED_ENC_CIPHER_CK2_1_ADDR A:0x43810a8
y.create.l HWIO_TX_UNIFIED_ENC_CIPHER_CK2_2_ADDR A:0x43810ac
y.create.l HWIO_TX_UNIFIED_ENC_CIPHER_CK2_3_ADDR A:0x43810b0
y.create.l HWIO_TX_UNIFIED_ENC_CIPHER_CK3_0_ADDR A:0x43810b4
y.create.l HWIO_TX_UNIFIED_ENC_CIPHER_CK3_1_ADDR A:0x43810b8
y.create.l HWIO_TX_UNIFIED_ENC_CIPHER_CK3_2_ADDR A:0x43810bc
y.create.l HWIO_TX_UNIFIED_ENC_CIPHER_CK3_3_ADDR A:0x43810c0
y.create.l HWIO_TX_UNIFIED_ENC_CIPHER_CK4_0_ADDR A:0x43810c4
y.create.l HWIO_TX_UNIFIED_ENC_CIPHER_CK4_1_ADDR A:0x43810c8
y.create.l HWIO_TX_UNIFIED_ENC_CIPHER_CK4_2_ADDR A:0x43810cc
y.create.l HWIO_TX_UNIFIED_ENC_CIPHER_CK4_3_ADDR A:0x43810d0
y.create.l HWIO_TX_UNIFIED_ENC_CIPHER_CK5_0_ADDR A:0x43810d4
y.create.l HWIO_TX_UNIFIED_ENC_CIPHER_CK5_1_ADDR A:0x43810d8
y.create.l HWIO_TX_UNIFIED_ENC_CIPHER_CK5_2_ADDR A:0x43810dc
y.create.l HWIO_TX_UNIFIED_ENC_CIPHER_CK5_3_ADDR A:0x43810e0
y.create.l HWIO_TX_UNIFIED_ENC_ERAM_INCRACC_INIT_ADDR A:0x43810e4
y.create.l HWIO_TX_UNIFIED_ENC_FILLER_POLARITY_ADDR A:0x43810e8
y.create.l HWIO_TX_TDS_TTI_ERUCCH_ADDR A:0x43810ec
y.create.l HWIO_TX_UNIFIED_ENC_EUL_CODING_PARAM_BANK0_ADDR A:0x43810f0
y.create.l HWIO_TX_UNIFIED_ENC_EUL_CODING_PARAM_BANK1_ADDR A:0x43810f4
y.create.l HWIO_TX_UNIFIED_ENC_EUL_CODE_SEG_SIZE_BANK0_ADDR A:0x43810f8
y.create.l HWIO_TX_UNIFIED_ENC_EUL_CODE_SEG_SIZE_BANK1_ADDR A:0x43810fc
y.create.l HWIO_TX_UNIFIED_ENC_EUL_TURBO_INTLV_PARAM0_BANK0_ADDR A:0x4381100
y.create.l HWIO_TX_UNIFIED_ENC_EUL_TURBO_INTLV_PARAM0_BANK1_ADDR A:0x4381104
y.create.l HWIO_TX_UNIFIED_ENC_EUL_TURBO_INTLV_PARAM1_BANK0_ADDR A:0x4381108
y.create.l HWIO_TX_UNIFIED_ENC_EUL_TURBO_INTLV_PARAM1_BANK1_ADDR A:0x438110c
y.create.l HWIO_TX_UNIFIED_ENC_OFFL_ENC_FRAME_ADDR A:0x4381110
y.create.l HWIO_TX_UNIFIED_EUL_ENC_TRIGGER_ADDR A:0x4381114
y.create.l HWIO_TX_UNIFIED_ENC_EUL_ENC_BANK_CFG_ADDR A:0x4381118
y.create.l HWIO_TX_1X_CH1_ENC_CTL_ADDR A:0x438111c
y.create.l HWIO_TX_1X_CH1_CRC_POLY_ADDR A:0x4381120
y.create.l HWIO_TX_1X_CH2_ENC_CTL_0_ADDR A:0x4381124
y.create.l HWIO_TX_1X_CH2_ENC_CTL_1_ADDR A:0x4381128
y.create.l HWIO_TX_1X_CH2_CRC_POLY_ADDR A:0x438112c
y.create.l HWIO_TX_1X_CH3_ENC_CTL_0_ADDR A:0x4381130
y.create.l HWIO_TX_1X_CH3_ENC_CTL_1_ADDR A:0x4381134
y.create.l HWIO_TX_1X_CH3_CRC_POLY_ADDR A:0x4381138
y.create.l HWIO_TX_DO_SCRAMB_INIT_0_ADDR A:0x438113c
y.create.l HWIO_TX_TDS_RM_EINI_ERUCCH_ADDR A:0x4381148
y.create.l HWIO_TX_TDS_RM_EMINUS_ERUCCH_ADDR A:0x438114c
y.create.l HWIO_TX_TDS_RM_EPLUS_ERUCCH_ADDR A:0x4381150
y.create.l HWIO_TX_TDS_CCTRCH_SI_ADDR A:0x4381154
y.create.l HWIO_TX_TDS_ERUCCH_ADDR_ADDR A:0x4381158
y.create.l HWIO_TX_TDS_CCTRCH_ADDR_ADDR A:0x438115c
y.create.l HWIO_TX_TDS_SLOT_DATA_NUM0_CCTRCH1_ADDR A:0x4381160
y.create.l HWIO_TX_TDS_SLOT_DATA_NUM1_CCTRCH1_ADDR A:0x4381164
y.create.l HWIO_TX_TDS_SLOT_DATA_NUM2_CCTRCH1_ADDR A:0x4381168
y.create.l HWIO_TX_TDS_SLOT_DATA_NUM0_CCTRCH2_ADDR A:0x438116c
y.create.l HWIO_TX_TDS_SLOT_DATA_NUM1_CCTRCH2_ADDR A:0x4381170
y.create.l HWIO_TX_TDS_SLOT_DATA_NUM2_CCTRCH2_ADDR A:0x4381174
y.create.l HWIO_TX_UNIFIED_ENC_EUL_RM_SYS_EINI_ADDR A:0x4381178
y.create.l HWIO_TX_UNIFIED_ENC_EUL_RM_SYS_EPLUS_EMINUS_ADDR A:0x438117c
y.create.l HWIO_TX_UNIFIED_ENC_EUL_RM_P1_EINI_ADDR A:0x4381180
y.create.l HWIO_TX_UNIFIED_ENC_EUL_RM_P1_EPLUS_ADDR A:0x4381184
y.create.l HWIO_TX_UNIFIED_ENC_EUL_RM_P1_EMINUS_ADDR A:0x4381188
y.create.l HWIO_TX_UNIFIED_ENC_EUL_RM_P2_EINI_ADDR A:0x438118c
y.create.l HWIO_TX_UNIFIED_ENC_EUL_RM_P2_EPLUS_EMINUS_ADDR A:0x4381190
y.create.l HWIO_TX_UNIFIED_ENC_EUL_RM_SYS_NUMBITS_ADDR A:0x4381194
y.create.l HWIO_TX_UNIFIED_ENC_EUL_RM_P1P2_NUMBITS_ADDR A:0x4381198
y.create.l HWIO_TX_TDS_EUL_NUMBITS_ADDR A:0x438119c
y.create.l HWIO_UMTS_TX_EUL_RM_RAM_BASE_ADDR_ADDR A:0x43811a0
y.create.l HWIO_TX_1X_CH1_PUNCT_PATN_1_ADDR A:0x43811a4
y.create.l HWIO_TX_1X_CH1_PUNCT_PATN_0_ADDR A:0x43811a8
y.create.l HWIO_TX_1X_CH2_PUNCT_PATN_1_ADDR A:0x43811ac
y.create.l HWIO_TX_1X_CH2_PUNCT_PATN_0_ADDR A:0x43811b0
y.create.l HWIO_TX_1X_CH3_PUNCT_PATN_1_ADDR A:0x43811b4
y.create.l HWIO_TX_1X_CH3_PUNCT_PATN_0_ADDR A:0x43811b8
y.create.l HWIO_TX_1X_LPN_BOZO_ADDR A:0x43811bc
y.create.l HWIO_TX_UNIFIED_PN_LD_ADDR A:0x43811c0
y.create.l HWIO_TX_UNIFIED_PN_MASK_LD_ADDR A:0x43811c4
y.create.l HWIO_TX_1X_I_PN_STATE_ADDR A:0x43811c8
y.create.l HWIO_TX_1X_Q_PN_STATE_ADDR A:0x43811cc
y.create.l HWIO_TX_1X_U_PN_MASK_0_ADDR A:0x43811d0
y.create.l HWIO_TX_1X_U_PN_MASK_1_ADDR A:0x43811d4
y.create.l HWIO_TX_1X_U_PN_STATE_0_ADDR A:0x43811d8
y.create.l HWIO_TX_1X_U_PN_STATE_1_ADDR A:0x43811dc
y.create.l HWIO_TX_DO_PN_STATE_0_ADDR A:0x43811e0
y.create.l HWIO_TX_DO_PN_STATE_1_ADDR A:0x43811e4
y.create.l HWIO_TX_DO_I_PN_MASK_0_C0_ADDR A:0x43811e8
y.create.l HWIO_TX_DO_I_PN_MASK_1_C0_ADDR A:0x43811f4
y.create.l HWIO_TX_DO_Q_PN_MASK_0_C0_ADDR A:0x4381200
y.create.l HWIO_TX_DO_Q_PN_MASK_1_C0_ADDR A:0x438120c
y.create.l HWIO_TX_DO_FOC_PN_CTL_C0_ADDR A:0x4381218
y.create.l HWIO_TX_DO_TRAFFIC_PN_CTL_ADDR A:0x4381224
y.create.l HWIO_TX_UMTS_SCR_CODE_INIT_ADDR A:0x4381228
y.create.l HWIO_TX_TDS_SCR_CODE_INIT_ADDR A:0x4381230
y.create.l HWIO_TX_1X_PICH_PCBIT_DATA_ADDR A:0x4381234
y.create.l HWIO_TX_1X_PICH_PCBIT_MASK_ADDR A:0x4381238
y.create.l HWIO_TX_DO_REV0_RRI_CTL_ADDR A:0x438123c
y.create.l HWIO_TX_DO_ACK_CTL_C0_ADDR A:0x4381240
y.create.l HWIO_TX_DO_DRC_CTL_C0_ADDR A:0x438124c
y.create.l HWIO_TX_DO_DSC_CTL_C0_ADDR A:0x4381258
y.create.l HWIO_TX_DO_REVAB_RRI_CTL_C0_ADDR A:0x4381264
y.create.l HWIO_TX_1X_FPC_BIT_ADDR A:0x4381270
y.create.l HWIO_TX_UMTS_PHY_CH_TYPE_ADDR A:0x4381274
y.create.l HWIO_TX_UMTS_RACH_CTL_ADDR A:0x4381278
y.create.l HWIO_TX_UMTS_RACH_OVSF_ADDR A:0x438127c
y.create.l HWIO_TX_UMTS_CTL_CH_DATA_ADDR A:0x4381280
y.create.l HWIO_TX_UMTS_SPARE_CH_DATA_ADDR A:0x4381284
y.create.l HWIO_TX_UMTS_SPARE_CH_CTL_ADDR A:0x4381288
y.create.l HWIO_TX_UNIFIED_SPARE_DATA_CH_CTL_0_ADDR A:0x438128c
y.create.l HWIO_TX_UNIFIED_SPARE_DATA_CH_CTL_1_ADDR A:0x4381290
y.create.l HWIO_TX_UNIFIED_SPARE_DATA_CH_FINE_CTL_0_ADDR A:0x4381294
y.create.l HWIO_TX_UNIFIED_SPARE_DATA_CH_FINE_CTL_1_ADDR A:0x4381298
y.create.l HWIO_TX_UMTS_DPDCH_CTL_ADDR A:0x438129c
y.create.l HWIO_TX_UMTS_HSDPCCH_CTL_ADDR A:0x43812a0
y.create.l HWIO_TX_UMTS_HSDPCCH_DATA_ADDR A:0x43812a4
y.create.l HWIO_TX_UMTS_EUL_NUMBITS_EDPDCH0_ADDR A:0x43812a8
y.create.l HWIO_TX_UMTS_EUL_NUMBITS_EDPDCH1_ADDR A:0x43812ac
y.create.l HWIO_TX_UMTS_EUL_NUMBITS_EDPDCH2_ADDR A:0x43812b0
y.create.l HWIO_TX_UMTS_EUL_NUMBITS_EDPDCH3_ADDR A:0x43812b4
y.create.l HWIO_TX_UMTS_EUL_EDPDCH_CONFIG_ADDR A:0x43812c8
y.create.l HWIO_TX_UMTS_EUL_EDPDCH_CTL0_ADDR A:0x43812cc
y.create.l HWIO_TX_UMTS_EUL_EDPDCH_CTL1_ADDR A:0x43812d0
y.create.l HWIO_TX_UMTS_EUL_EDPDCH_CTL2_ADDR A:0x43812d4
y.create.l HWIO_TX_UMTS_EUL_EDPDCH_CTL3_ADDR A:0x43812d8
y.create.l HWIO_TX_UMTS_EUL_EDPCCH_CTL_ADDR A:0x43812dc
y.create.l HWIO_TX_UMTS_EUL_EDPCCH_DATA_ADDR A:0x43812e0
y.create.l HWIO_TX_TDS_EUCCH_ADDR A:0x43812e4
y.create.l HWIO_TX_TDS_HSSICH0_ADDR A:0x43812e8
y.create.l HWIO_TX_TDS_HSSICH1_ADDR A:0x43812ec
y.create.l HWIO_TX_TDS_HSSICH2_ADDR A:0x43812f0
y.create.l HWIO_TX_TDS_SYNC_UL0_ADDR A:0x43812f4
y.create.l HWIO_TX_TDS_SYNC_UL1_ADDR A:0x43812f8
y.create.l HWIO_TX_TDS_SYNC_UL2_ADDR A:0x43812fc
y.create.l HWIO_TX_TDS_SYNC_UL3_ADDR A:0x4381300
y.create.l HWIO_TX_TDS_MIDAMBLE_SHIFT_ADDR A:0x4381304
y.create.l HWIO_TX_TDS_MIDAMBLE0_ADDR A:0x4381308
y.create.l HWIO_TX_TDS_MIDAMBLE1_ADDR A:0x438130c
y.create.l HWIO_TX_TDS_MIDAMBLE2_ADDR A:0x4381310
y.create.l HWIO_TX_TDS_MIDAMBLE3_ADDR A:0x4381314
y.create.l HWIO_TX_TDS_SLOT_CTL_PHY_CH0_ADDR A:0x4381318
y.create.l HWIO_TX_TDS_SLOT_CTL_PHY_CH1_ADDR A:0x438131c
y.create.l HWIO_TX_TDS_SS_PHY_CH0_ADDR A:0x4381320
y.create.l HWIO_TX_TDS_SS_PHY_CH1_ADDR A:0x4381324
y.create.l HWIO_TX_TDS_TFCI_PHY_CH0_ADDR A:0x4381328
y.create.l HWIO_TX_TDS_TFCI_PHY_CH1_ADDR A:0x438132c
y.create.l HWIO_TX_TDS_TPC_PHY_CH0_ADDR A:0x4381330
y.create.l HWIO_TX_TDS_TPC_PHY_CH1_ADDR A:0x4381334
y.create.l HWIO_TX_UNIFIED_NUM_ZEROS_FLUSH_ADDR A:0x4381338
y.create.l HWIO_TX_UNIFIED_FRAME_OFFSET_ADDR A:0x438133c
y.create.l HWIO_TX_UNIFIED_FRAME_OFF_LD_ADDR A:0x4381340
y.create.l HWIO_TX_UNIFIED_SAMPLE_CNT_INIT_VAL_ADDR A:0x4381344
y.create.l HWIO_TX_UNIFIED_SAMPLE_CNT_LD_ADDR A:0x4381348
y.create.l HWIO_TX_UNIFIED_SAMPLE_CNT_READ_ADDR A:0x438134c
y.create.l HWIO_TX_UNIFIED_SAMPLE_CNT_UPDATE_TIME_ADDR A:0x4381350
y.create.l HWIO_TX_UMTS_EUL_TTI_MODE_ADDR A:0x4381354
y.create.l HWIO_TX_UMTS_HSDPCCH_OFFSET_ADDR A:0x4381358
y.create.l HWIO_TX_UNIFIED_BETAP_GAIN_UPDATE_ADDR A:0x438135c
y.create.l HWIO_TX_UNIFIED_PA_RANGE_UPDATE_ADDR A:0x4381360
y.create.l HWIO_TX_UNIFIED_OFFL_EN_ADDR A:0x4381364
y.create.l HWIO_TX_UNIFIED_DTX_EN_ADDR A:0x4381368
y.create.l HWIO_TX_UNIFIED_ERAM_CTL_ADDR A:0x438136c
y.create.l HWIO_TX_TDS_EUL_RM_BANK_SEL_ADDR A:0x4381370
y.create.l HWIO_TX_UNIFIED_ENC_STATUS_ADDR A:0x4381374
y.create.l HWIO_TX_TDS_GUARD_PERIOD_ADDR A:0x4381378
y.create.l HWIO_TX_1X_DBR_MASK_READ_ADDR A:0x438137c
y.create.l HWIO_TX_TDS_NEW_SUBFRAME_FW_ADDR A:0x4381380
y.create.l HWIO_TX_1X_MISC_CTL_ADDR A:0x4381384
y.create.l HWIO_TX_UNIFIED_CARRIER_EN_ADDR A:0x4381388
y.create.l HWIO_TX_DO_GAIN_BANK_ADDR A:0x438138c
y.create.l HWIO_TX_UNIFIED_GAIN_0_ADDR A:0x4381390
y.create.l HWIO_TX_UNIFIED_GAIN_1_ADDR A:0x4381394
y.create.l HWIO_TX_UNIFIED_GAIN_2_ADDR A:0x4381398
y.create.l HWIO_TX_UNIFIED_GAIN_3_ADDR A:0x438139c
y.create.l HWIO_TX_UNIFIED_GAIN_4_ADDR A:0x43813a0
y.create.l HWIO_TX_UNIFIED_GAIN_5_ADDR A:0x43813a4
y.create.l HWIO_TX_C2K_BETAP_GAIN_C0_ADDR A:0x43813a8
y.create.l HWIO_TX_UNIFIED_ADVRET_CMD_ADDR A:0x43813b4
y.create.l HWIO_TX_UNIFIED_ADVRET_TYPE_ADDR A:0x43813b8
y.create.l HWIO_TX_1X_MOD_WCOVER_SEL_ADDR A:0x43813bc
y.create.l HWIO_TX_DO_CTL_C0_ADDR A:0x43813c0
y.create.l HWIO_TX_TDS_NUM_DATA_PHY_CH0_ADDR A:0x43813cc
y.create.l HWIO_TX_TDS_NUM_DATA_PHY_CH1_ADDR A:0x43813d0
y.create.l HWIO_TX_TDS_SPR_FACTOR_CTL_ADDR A:0x43813d4
y.create.l HWIO_TX_TDS_EUL_MOD_CTL_ADDR A:0x43813d8
y.create.l HWIO_TX_TDS_SLOT_IDX_ADDR A:0x43813dc
y.create.l HWIO_TX_UMTS_DCH_RACH_LAST_ADDR A:0x43813e0
y.create.l HWIO_TX_UNIFIED_PRED_CLIP_BYPASS_ADDR A:0x43813e4
y.create.l HWIO_TX_UNIFIED_PRED_CLIP_C0_ADDR A:0x43813e8
y.create.l HWIO_TX_UNIFIED_PRED_CLIP_GLOBAL_ADDR A:0x43813f4
y.create.l HWIO_TX_TDS_BBF_WINDOW_ADDR A:0x43813f8
y.create.l HWIO_TX_UNIFIED_PA_RANGE_ADDR A:0x43813fc
y.create.l HWIO_TX_UNIFIED_ROTANGLE_0_ADDR A:0x4381400
y.create.l HWIO_TX_UNIFIED_ROTANGLE_1_ADDR A:0x4381404
y.create.l HWIO_TX_UNIFIED_ROT_FREQ_STEP_C0_ADDR A:0x4381408
y.create.l HWIO_TX_UNIFIED_CRC_BYPASS_ADDR A:0x4381414
y.create.l HWIO_TX_UNIFIED_MEM_PTR_EN_ADDR A:0x4381418
y.create.l HWIO_TX_MEM_ERAM_ADDR_0_ADDR A:0x438145c
y.create.l HWIO_TX_MEM_ERAM_ADDR_1_ADDR A:0x4381460
y.create.l HWIO_TX_MEM_ERAM_ADDR_2_ADDR A:0x4381464
y.create.l HWIO_TX_MEM_ERAM_ADDR_3_ADDR A:0x4381468
y.create.l HWIO_TX_MEM_ERAM_ADDR_4_ADDR A:0x438146c
y.create.l HWIO_TX_MEM_ERAM_ADDR_5_ADDR A:0x4381470
y.create.l HWIO_TX_MEM_ERAM_ADDR_6_ADDR A:0x4381474
y.create.l HWIO_TX_MEM_ERAM_ADDR_7_ADDR A:0x4381478
y.create.l HWIO_TX_MEM_ERAM_ADDR_8_ADDR A:0x438147c
y.create.l HWIO_TX_MEM_ERAM_ADDR_9_ADDR A:0x4381480
y.create.l HWIO_TX_MEM_IRAM_ADDR_0_ADDR A:0x4381490
y.create.l HWIO_TX_MEM_IRAM_ADDR_1_ADDR A:0x4381494
y.create.l HWIO_TX_MEM_IRAM_ADDR_2_ADDR A:0x4381498
y.create.l HWIO_TX_MEM_IRAM_ADDR_3_ADDR A:0x438149c
y.create.l HWIO_TX_MEM_IRAM_ADDR_4_ADDR A:0x43814a0
y.create.l HWIO_TX_MEM_IRAM_ADDR_5_ADDR A:0x43814a4
y.create.l HWIO_TX_MEM_IRAM_ADDR_6_ADDR A:0x43814a8
y.create.l HWIO_TX_MEM_IRAM_ADDR_7_ADDR A:0x43814ac
y.create.l HWIO_TX_MEM_IRAM_ADDR_8_ADDR A:0x43814b0
y.create.l HWIO_TX_MEM_IRAM_ADDR_9_ADDR A:0x43814b4
y.create.l HWIO_TX_SUMTS_DECIMATE_ADDR A:0x43814c4
y.create.l HWIO_TX_UNIFIED_ENC_TRBLK_PARAM_TRCH0_ADDR A:0x4381800
y.create.l HWIO_TX_UNIFIED_ENC_TRBLK_PARAM_TRCH1_ADDR A:0x4381804
y.create.l HWIO_TX_UNIFIED_ENC_TRBLK_PARAM_TRCH2_ADDR A:0x4381808
y.create.l HWIO_TX_UNIFIED_ENC_TRBLK_PARAM_TRCH3_ADDR A:0x438180c
y.create.l HWIO_TX_UNIFIED_ENC_TRBLK_PARAM_TRCH4_ADDR A:0x4381810
y.create.l HWIO_TX_UNIFIED_ENC_TRBLK_PARAM_TRCH5_ADDR A:0x4381814
y.create.l HWIO_TX_UNIFIED_ENC_TRBLK_PARAM_TRCH6_ADDR A:0x4381818
y.create.l HWIO_TX_UNIFIED_ENC_TRBLK_PARAM_TRCH7_ADDR A:0x438181c
y.create.l HWIO_TX_UNIFIED_ENC_ERAMB_ADDR_TRCH0_ADDR A:0x4381820
y.create.l HWIO_TX_UNIFIED_ENC_ERAMB_ADDR_TRCH1_ADDR A:0x4381824
y.create.l HWIO_TX_UNIFIED_ENC_ERAMB_ADDR_TRCH2_ADDR A:0x4381828
y.create.l HWIO_TX_UNIFIED_ENC_ERAMB_ADDR_TRCH3_ADDR A:0x438182c
y.create.l HWIO_TX_UNIFIED_ENC_ERAMB_ADDR_TRCH4_ADDR A:0x4381830
y.create.l HWIO_TX_UNIFIED_ENC_ERAMB_ADDR_TRCH5_ADDR A:0x4381834
y.create.l HWIO_TX_UNIFIED_ENC_ERAMB_ADDR_TRCH6_ADDR A:0x4381838
y.create.l HWIO_TX_UNIFIED_ENC_ERAMB_ADDR_TRCH7_ADDR A:0x438183c
y.create.l HWIO_TX_UNIFIED_ENC_CODING_PARAM_TRCH0_ADDR A:0x4381900
y.create.l HWIO_TX_UNIFIED_ENC_CODING_PARAM_TRCH1_ADDR A:0x4381904
y.create.l HWIO_TX_UNIFIED_ENC_CODING_PARAM_TRCH2_ADDR A:0x4381908
y.create.l HWIO_TX_UNIFIED_ENC_CODING_PARAM_TRCH3_ADDR A:0x438190c
y.create.l HWIO_TX_UNIFIED_ENC_CODING_PARAM_TRCH4_ADDR A:0x4381910
y.create.l HWIO_TX_UNIFIED_ENC_CODING_PARAM_TRCH5_ADDR A:0x4381914
y.create.l HWIO_TX_UNIFIED_ENC_CODING_PARAM_TRCH6_ADDR A:0x4381918
y.create.l HWIO_TX_UNIFIED_ENC_CODING_PARAM_TRCH7_ADDR A:0x438191c
y.create.l HWIO_TX_UNIFIED_ENC_CODE_SEG_SIZE_TRCH0_ADDR A:0x4381920
y.create.l HWIO_TX_UNIFIED_ENC_CODE_SEG_SIZE_TRCH1_ADDR A:0x4381924
y.create.l HWIO_TX_UNIFIED_ENC_CODE_SEG_SIZE_TRCH2_ADDR A:0x4381928
y.create.l HWIO_TX_UNIFIED_ENC_CODE_SEG_SIZE_TRCH3_ADDR A:0x438192c
y.create.l HWIO_TX_UNIFIED_ENC_CODE_SEG_SIZE_TRCH4_ADDR A:0x4381930
y.create.l HWIO_TX_UNIFIED_ENC_CODE_SEG_SIZE_TRCH5_ADDR A:0x4381934
y.create.l HWIO_TX_UNIFIED_ENC_CODE_SEG_SIZE_TRCH6_ADDR A:0x4381938
y.create.l HWIO_TX_UNIFIED_ENC_CODE_SEG_SIZE_TRCH7_ADDR A:0x438193c
y.create.l HWIO_TX_UNIFIED_ENC_RM_EINI_TRCH0_ADDR A:0x4381940
y.create.l HWIO_TX_UNIFIED_ENC_RM_EINI_TRCH1_ADDR A:0x4381944
y.create.l HWIO_TX_UNIFIED_ENC_RM_EINI_TRCH2_ADDR A:0x4381948
y.create.l HWIO_TX_UNIFIED_ENC_RM_EINI_TRCH3_ADDR A:0x438194c
y.create.l HWIO_TX_UNIFIED_ENC_RM_EINI_TRCH4_ADDR A:0x4381950
y.create.l HWIO_TX_UNIFIED_ENC_RM_EINI_TRCH5_ADDR A:0x4381954
y.create.l HWIO_TX_UNIFIED_ENC_RM_EINI_TRCH6_ADDR A:0x4381958
y.create.l HWIO_TX_UNIFIED_ENC_RM_EINI_TRCH7_ADDR A:0x438195c
y.create.l HWIO_TX_UNIFIED_ENC_RM_EMINUS_TRCH0_ADDR A:0x4381960
y.create.l HWIO_TX_UNIFIED_ENC_RM_EMINUS_TRCH1_ADDR A:0x4381964
y.create.l HWIO_TX_UNIFIED_ENC_RM_EMINUS_TRCH2_ADDR A:0x4381968
y.create.l HWIO_TX_UNIFIED_ENC_RM_EMINUS_TRCH3_ADDR A:0x438196c
y.create.l HWIO_TX_UNIFIED_ENC_RM_EMINUS_TRCH4_ADDR A:0x4381970
y.create.l HWIO_TX_UNIFIED_ENC_RM_EMINUS_TRCH5_ADDR A:0x4381974
y.create.l HWIO_TX_UNIFIED_ENC_RM_EMINUS_TRCH6_ADDR A:0x4381978
y.create.l HWIO_TX_UNIFIED_ENC_RM_EMINUS_TRCH7_ADDR A:0x438197c
y.create.l HWIO_TX_UNIFIED_ENC_RM_EPLUS_TRCH0_ADDR A:0x4381980
y.create.l HWIO_TX_UNIFIED_ENC_RM_EPLUS_TRCH1_ADDR A:0x4381984
y.create.l HWIO_TX_UNIFIED_ENC_RM_EPLUS_TRCH2_ADDR A:0x4381988
y.create.l HWIO_TX_UNIFIED_ENC_RM_EPLUS_TRCH3_ADDR A:0x438198c
y.create.l HWIO_TX_UNIFIED_ENC_RM_EPLUS_TRCH4_ADDR A:0x4381990
y.create.l HWIO_TX_UNIFIED_ENC_RM_EPLUS_TRCH5_ADDR A:0x4381994
y.create.l HWIO_TX_UNIFIED_ENC_RM_EPLUS_TRCH6_ADDR A:0x4381998
y.create.l HWIO_TX_UNIFIED_ENC_RM_EPLUS_TRCH7_ADDR A:0x438199c
y.create.l HWIO_TX_UNIFIED_ENC_TURBO_INTLV_PARAM0_TRCH0_ADDR A:0x43819a0
y.create.l HWIO_TX_UNIFIED_ENC_TURBO_INTLV_PARAM0_TRCH1_ADDR A:0x43819a4
y.create.l HWIO_TX_UNIFIED_ENC_TURBO_INTLV_PARAM0_TRCH2_ADDR A:0x43819a8
y.create.l HWIO_TX_UNIFIED_ENC_TURBO_INTLV_PARAM0_TRCH3_ADDR A:0x43819ac
y.create.l HWIO_TX_UNIFIED_ENC_TURBO_INTLV_PARAM0_TRCH4_ADDR A:0x43819b0
y.create.l HWIO_TX_UNIFIED_ENC_TURBO_INTLV_PARAM0_TRCH5_ADDR A:0x43819b4
y.create.l HWIO_TX_UNIFIED_ENC_TURBO_INTLV_PARAM0_TRCH6_ADDR A:0x43819b8
y.create.l HWIO_TX_UNIFIED_ENC_TURBO_INTLV_PARAM0_TRCH7_ADDR A:0x43819bc
y.create.l HWIO_TX_UNIFIED_ENC_TURBO_INTLV_PARAM1_TRCH0_ADDR A:0x43819c0
y.create.l HWIO_TX_UNIFIED_ENC_TURBO_INTLV_PARAM1_TRCH1_ADDR A:0x43819c4
y.create.l HWIO_TX_UNIFIED_ENC_TURBO_INTLV_PARAM1_TRCH2_ADDR A:0x43819c8
y.create.l HWIO_TX_UNIFIED_ENC_TURBO_INTLV_PARAM1_TRCH3_ADDR A:0x43819cc
y.create.l HWIO_TX_UNIFIED_ENC_TURBO_INTLV_PARAM1_TRCH4_ADDR A:0x43819d0
y.create.l HWIO_TX_UNIFIED_ENC_TURBO_INTLV_PARAM1_TRCH5_ADDR A:0x43819d4
y.create.l HWIO_TX_UNIFIED_ENC_TURBO_INTLV_PARAM1_TRCH6_ADDR A:0x43819d8
y.create.l HWIO_TX_UNIFIED_ENC_TURBO_INTLV_PARAM1_TRCH7_ADDR A:0x43819dc
y.create.l HWIO_TX_UNIFIED_ENC_ERAM_DATA_INCRACC_0_ADDR A:0x4381a00
y.create.l HWIO_TX_UNIFIED_ENC_ERAM_DATA_INCRACC_1_ADDR A:0x4381a04
y.create.l HWIO_TX_UNIFIED_ENC_ERAM_DATA_INCRACC_2_ADDR A:0x4381a08
y.create.l HWIO_TX_UNIFIED_ENC_ERAM_DATA_INCRACC_3_ADDR A:0x4381a0c
y.create.l HWIO_TX_UNIFIED_ENC_TRCH_MUX_ORDER_CCTRCH1_ADDR A:0x4381a20
y.create.l HWIO_TX_TDS_TRCH_MUX_ORDER_CCTRCH2_ADDR A:0x4381a40
y.create.l HWIO_TX_TDS_DPCH0_LAST_SLOT0_BANK0_ADDR A:0x4381b00
y.create.l HWIO_TX_TDS_DPCH0_LAST_SLOT1_BANK0_ADDR A:0x4381b04
y.create.l HWIO_TX_TDS_DPCH0_LAST_SLOT2_BANK0_ADDR A:0x4381b08
y.create.l HWIO_TX_TDS_DPCH0_LAST_SLOT3_BANK0_ADDR A:0x4381b0c
y.create.l HWIO_TX_TDS_DPCH0_LAST_SLOT4_BANK0_ADDR A:0x4381b10
y.create.l HWIO_TX_TDS_DPCH0_SLOT0_BANK0_ADDR A:0x4381b40
y.create.l HWIO_TX_TDS_DPCH0_SLOT1_BANK0_ADDR A:0x4381b44
y.create.l HWIO_TX_TDS_DPCH0_SLOT2_BANK0_ADDR A:0x4381b48
y.create.l HWIO_TX_TDS_DPCH0_SLOT3_BANK0_ADDR A:0x4381b4c
y.create.l HWIO_TX_TDS_DPCH0_SLOT4_BANK0_ADDR A:0x4381b50
y.create.l HWIO_TX_TDS_DPCH0_SLOT5_BANK0_ADDR A:0x4381b54
y.create.l HWIO_TX_TDS_DPCH0_SLOT6_BANK0_ADDR A:0x4381b58
y.create.l HWIO_TX_TDS_DPCH0_SLOT7_BANK0_ADDR A:0x4381b5c
y.create.l HWIO_TX_TDS_DPCH0_SLOT8_BANK0_ADDR A:0x4381b60
y.create.l HWIO_TX_TDS_DPCH0_SLOT9_BANK0_ADDR A:0x4381b64
y.create.l HWIO_TX_TDS_DPCH1_LAST_SLOT0_BANK0_ADDR A:0x4381b80
y.create.l HWIO_TX_TDS_DPCH1_LAST_SLOT1_BANK0_ADDR A:0x4381b84
y.create.l HWIO_TX_TDS_DPCH1_LAST_SLOT2_BANK0_ADDR A:0x4381b88
y.create.l HWIO_TX_TDS_DPCH1_LAST_SLOT3_BANK0_ADDR A:0x4381b8c
y.create.l HWIO_TX_TDS_DPCH1_LAST_SLOT4_BANK0_ADDR A:0x4381b90
y.create.l HWIO_TX_TDS_DPCH1_SLOT0_BANK0_ADDR A:0x4381bc0
y.create.l HWIO_TX_TDS_DPCH1_SLOT1_BANK0_ADDR A:0x4381bc4
y.create.l HWIO_TX_TDS_DPCH1_SLOT2_BANK0_ADDR A:0x4381bc8
y.create.l HWIO_TX_TDS_DPCH1_SLOT3_BANK0_ADDR A:0x4381bcc
y.create.l HWIO_TX_TDS_DPCH1_SLOT4_BANK0_ADDR A:0x4381bd0
y.create.l HWIO_TX_TDS_DPCH1_SLOT5_BANK0_ADDR A:0x4381bd4
y.create.l HWIO_TX_TDS_DPCH1_SLOT6_BANK0_ADDR A:0x4381bd8
y.create.l HWIO_TX_TDS_DPCH1_SLOT7_BANK0_ADDR A:0x4381bdc
y.create.l HWIO_TX_TDS_DPCH1_SLOT8_BANK0_ADDR A:0x4381be0
y.create.l HWIO_TX_TDS_DPCH1_SLOT9_BANK0_ADDR A:0x4381be4
y.create.l HWIO_TX_TDS_EPUCH_LAST_BANK0_ADDR A:0x4381c00
y.create.l HWIO_TX_TDS_EPUCH_SLOT0_BANK0_ADDR A:0x4381c20
y.create.l HWIO_TX_TDS_EPUCH_SLOT1_BANK0_ADDR A:0x4381c24
y.create.l HWIO_TX_TDS_EPUCH_SLOT2_BANK0_ADDR A:0x4381c28
y.create.l HWIO_TX_TDS_EPUCH_SLOT3_BANK0_ADDR A:0x4381c2c
y.create.l HWIO_TX_TDS_EPUCH_SLOT4_BANK0_ADDR A:0x4381c30
y.create.l HWIO_TX_TDS_ERUCCH_LAST_BANK0_ADDR A:0x4381c40
y.create.l HWIO_TX_TDS_ERUCCH_SUBFRAME0_BANK0_ADDR A:0x4381c60
y.create.l HWIO_TX_TDS_ERUCCH_SUBFRAME1_BANK0_ADDR A:0x4381c64
y.create.l HWIO_TX_TDS_DPCH0_LAST_SLOT0_BANK1_ADDR A:0x4381ca0
y.create.l HWIO_TX_TDS_DPCH0_LAST_SLOT1_BANK1_ADDR A:0x4381ca4
y.create.l HWIO_TX_TDS_DPCH0_LAST_SLOT2_BANK1_ADDR A:0x4381ca8
y.create.l HWIO_TX_TDS_DPCH0_LAST_SLOT3_BANK1_ADDR A:0x4381cac
y.create.l HWIO_TX_TDS_DPCH0_LAST_SLOT4_BANK1_ADDR A:0x4381cb0
y.create.l HWIO_TX_TDS_DPCH0_SLOT0_BANK1_ADDR A:0x4381cc0
y.create.l HWIO_TX_TDS_DPCH0_SLOT1_BANK1_ADDR A:0x4381cc4
y.create.l HWIO_TX_TDS_DPCH0_SLOT2_BANK1_ADDR A:0x4381cc8
y.create.l HWIO_TX_TDS_DPCH0_SLOT3_BANK1_ADDR A:0x4381ccc
y.create.l HWIO_TX_TDS_DPCH0_SLOT4_BANK1_ADDR A:0x4381cd0
y.create.l HWIO_TX_TDS_DPCH0_SLOT5_BANK1_ADDR A:0x4381cd4
y.create.l HWIO_TX_TDS_DPCH0_SLOT6_BANK1_ADDR A:0x4381cd8
y.create.l HWIO_TX_TDS_DPCH0_SLOT7_BANK1_ADDR A:0x4381cdc
y.create.l HWIO_TX_TDS_DPCH0_SLOT8_BANK1_ADDR A:0x4381ce0
y.create.l HWIO_TX_TDS_DPCH0_SLOT9_BANK1_ADDR A:0x4381ce4
y.create.l HWIO_TX_TDS_DPCH1_LAST_SLOT0_BANK1_ADDR A:0x4381d00
y.create.l HWIO_TX_TDS_DPCH1_LAST_SLOT1_BANK1_ADDR A:0x4381d04
y.create.l HWIO_TX_TDS_DPCH1_LAST_SLOT2_BANK1_ADDR A:0x4381d08
y.create.l HWIO_TX_TDS_DPCH1_LAST_SLOT3_BANK1_ADDR A:0x4381d0c
y.create.l HWIO_TX_TDS_DPCH1_LAST_SLOT4_BANK1_ADDR A:0x4381d10
y.create.l HWIO_TX_TDS_DPCH1_SLOT0_BANK1_ADDR A:0x4381d40
y.create.l HWIO_TX_TDS_DPCH1_SLOT1_BANK1_ADDR A:0x4381d44
y.create.l HWIO_TX_TDS_DPCH1_SLOT2_BANK1_ADDR A:0x4381d48
y.create.l HWIO_TX_TDS_DPCH1_SLOT3_BANK1_ADDR A:0x4381d4c
y.create.l HWIO_TX_TDS_DPCH1_SLOT4_BANK1_ADDR A:0x4381d50
y.create.l HWIO_TX_TDS_DPCH1_SLOT5_BANK1_ADDR A:0x4381d54
y.create.l HWIO_TX_TDS_DPCH1_SLOT6_BANK1_ADDR A:0x4381d58
y.create.l HWIO_TX_TDS_DPCH1_SLOT7_BANK1_ADDR A:0x4381d5c
y.create.l HWIO_TX_TDS_DPCH1_SLOT8_BANK1_ADDR A:0x4381d60
y.create.l HWIO_TX_TDS_DPCH1_SLOT9_BANK1_ADDR A:0x4381d64
y.create.l HWIO_TX_TDS_EPUCH_LAST_BANK1_ADDR A:0x4381d80
y.create.l HWIO_TX_TDS_EPUCH_SLOT0_BANK1_ADDR A:0x4381da0
y.create.l HWIO_TX_TDS_EPUCH_SLOT1_BANK1_ADDR A:0x4381da4
y.create.l HWIO_TX_TDS_EPUCH_SLOT2_BANK1_ADDR A:0x4381da8
y.create.l HWIO_TX_TDS_EPUCH_SLOT3_BANK1_ADDR A:0x4381dac
y.create.l HWIO_TX_TDS_EPUCH_SLOT4_BANK1_ADDR A:0x4381db0
y.create.l HWIO_TX_TDS_ERUCCH_LAST_BANK1_ADDR A:0x4381dc0
y.create.l HWIO_TX_TDS_ERUCCH_SUBFRAME0_BANK1_ADDR A:0x4381de0
y.create.l HWIO_TX_TDS_ERUCCH_SUBFRAME1_BANK1_ADDR A:0x4381de4
y.create.l HWIO_TX_DO_GAIN_0_1_C0_BANK0_ADDR A:0x4381e00
y.create.l HWIO_TX_DO_GAIN_2_3_C0_BANK0_ADDR A:0x4381e0c
y.create.l HWIO_TX_DO_GAIN_4_5_C0_BANK0_ADDR A:0x4381e18
y.create.l HWIO_TX_DO_GAIN_6_7_C0_BANK0_ADDR A:0x4381e24
y.create.l HWIO_TX_DO_GAIN_8_9_C0_BANK0_ADDR A:0x4381e30
y.create.l HWIO_TX_DO_GAIN_0_1_C0_BANK1_ADDR A:0x4381f00
y.create.l HWIO_TX_DO_GAIN_2_3_C0_BANK1_ADDR A:0x4381f0c
y.create.l HWIO_TX_DO_GAIN_4_5_C0_BANK1_ADDR A:0x4381f18
y.create.l HWIO_TX_DO_GAIN_6_7_C0_BANK1_ADDR A:0x4381f24
y.create.l HWIO_TX_DO_GAIN_8_9_C0_BANK1_ADDR A:0x4381f30
y.create.l HWIO_TX_MEM_START_ADDR A:0x4382000
y.create.l HWIO_TX_RDR0_CFG0_ADDR A:0x4383000
y.create.l HWIO_TX_RDR1_CFG0_ADDR A:0x4383008
y.create.l HWIO_TX_RDR0_CFG1_ADDR A:0x4383004
y.create.l HWIO_TX_RDR1_CFG1_ADDR A:0x438300c
y.create.l HWIO_TX_RDR0_XFER_CTL_ADDR A:0x4383010
y.create.l HWIO_TX_RDR1_XFER_CTL_ADDR A:0x4383014
y.create.l HWIO_TX_WRTR_CFG0_ADDR A:0x4383018
y.create.l HWIO_TX_WRTR_CFG1_ADDR A:0x438301c
y.create.l HWIO_TX_WRTR_XFER_CTL_ADDR A:0x4383020
y.create.l HWIO_TX_BRDG_CTL_ADDR A:0x4383024
y.create.l HWIO_TX_BRDG_STATUS_ADDR A:0x4383028
y.create.l HWIO_TX_BRDG_CLEAR_ADDR A:0x438302c
y.create.l HWIO_TX_BRDG_ARB_PRI_ADDR A:0x4383030
y.create.l HWIO_TX_RDR0_VBUF_ADDR_ADDR A:0x4383034
y.create.l HWIO_TX_RDR1_VBUF_ADDR_ADDR A:0x4383038
y.create.l HWIO_TX_WRTR_VBUF_ADDR_ADDR A:0x438303c
y.create.l HWIO_TX_BRDG_AXI_PRI_ADDR A:0x4383040
y.create.l HWIO_TXR_IQ_DAC_A0_ADDR A:0x4385000
y.create.l HWIO_TXR_STR_CTRL_A0_ADDR A:0x4385008
y.create.l HWIO_TXR_PDA_CTRL_A0_ADDR A:0x438500c
y.create.l HWIO_TXR_PDA_WD_UPDATE_CTRL_A0_ADDR A:0x4385010
y.create.l HWIO_TXR_PDA_CTRL_WD_OFFSET_A0_ADDR A:0x4385014
y.create.l HWIO_TXR_PDA_OFFSET_CMD_A0_ADDR A:0x4385018
y.create.l HWIO_TXR_PPDSM_CTL_A0_ADDR A:0x438501c
y.create.l HWIO_TXR_PPDSM_OVERRIDE_VAL_A0_ADDR A:0x4385020
y.create.l HWIO_TXR_PPDSM_OVERRIDE_REP_A0_ADDR A:0x4385024
y.create.l HWIO_TXR_FIFO_PTR_DIFF_A_A0_ADDR A:0x4385028
y.create.l HWIO_TXR_FIFO_PTR_DIFF_B_A0_ADDR A:0x438502c
y.create.l HWIO_TXR_FIFO_STATUS_A_A0_ADDR A:0x4385030
y.create.l HWIO_TXR_FIFO_STATUS_B_A0_ADDR A:0x4385034
y.create.l HWIO_TXR_FIFO_CMD_A0_ADDR A:0x4385038
y.create.l HWIO_TXR_FIFO_CTRL_A0_ADDR A:0x438503c
y.create.l HWIO_TXR_STREAM_IF_CTRL_A0_ADDR A:0x4385040
y.create.l HWIO_TXR_FMT_CONV_CTL_A0_ADDR A:0x4385050
y.create.l HWIO_TXR_TEST_BUS_IN_IQ_SWAP_A0_ADDR A:0x4385054
y.create.l HWIO_TXR_TEST_BUS_OUT_IQ_SWAP_A0_ADDR A:0x4385058
y.create.l HWIO_TXR_IQ_DAC_CURRENT_A0_ADDR A:0x438505c
y.create.l HWIO_TXR_STR_CTRL_CURRENT_A0_ADDR A:0x4385060
y.create.l HWIO_TXR_PDA_CTRL_CURRENT_A0_ADDR A:0x4385064
y.create.l HWIO_TXR_PDA_WD_UPDATE_CTRL_CURRENT_A0_ADDR A:0x4385068
y.create.l HWIO_TXR_PDA_CTRL_WD_OFFSET_CURRENT_A0_ADDR A:0x438506c
y.create.l HWIO_TXR_PDA_OFFSET_CMD_CURRENT_A0_ADDR A:0x4385070
y.create.l HWIO_TXR_PPDSM_CTL_CURRENT_A0_ADDR A:0x4385074
y.create.l HWIO_TXR_PPDSM_OVERRIDE_VAL_CURRENT_A0_ADDR A:0x4385078
y.create.l HWIO_TXR_PPDSM_OVERRIDE_REP_CURRENT_A0_ADDR A:0x438507c
y.create.l HWIO_TXR_STREAM_IF_CTRL_CURRENT_A0_ADDR A:0x4385080
y.create.l HWIO_TXR_FMT_CONV_CTL_CURRENT_A0_ADDR A:0x4385084
y.create.l HWIO_TXC_TECH_SEL_A0_ADDR A:0x4384000
y.create.l HWIO_TXC_DP_CFG_A0_ADDR A:0x4384004
y.create.l HWIO_TXC_DP_CFG_2_A0_ADDR A:0x4384008
y.create.l HWIO_TXC_DP_ENV_SCALE_VAL_A0_ADDR A:0x4384010
y.create.l HWIO_TXC_DP_ENV_SCALE_VAL_SET2_A0_ADDR A:0x4384014
y.create.l HWIO_TXC_DP_ENV_SCALE_VAL_IMM_A0_ADDR A:0x4384018
y.create.l HWIO_TXC_DP_RAMP_ARM_A0_ADDR A:0x4384024
y.create.l HWIO_TXC_DP_RAMP_START_TIME_A0_ADDR A:0x4384028
y.create.l HWIO_TXC_DP_RAMP_SLOT_A_CFG_A0_ADDR A:0x4384038
y.create.l HWIO_TXC_DP_RAMP_SLOT_B_CFG_A0_ADDR A:0x438403c
y.create.l HWIO_TXC_DP_RAMP_GAP_A0_ADDR A:0x4384040
y.create.l HWIO_TXC_DP_RAMP_SLOT_A_CFG_ACT_A0_ADDR A:0x4384044
y.create.l HWIO_TXC_DP_RAMP_SLOT_B_CFG_ACT_A0_ADDR A:0x4384048
y.create.l HWIO_TXC_DP_RAMP_GAP_ACT_A0_ADDR A:0x438404c
y.create.l HWIO_TXC_DP_PHASE_OVR_VAL_A0_ADDR A:0x4384080
y.create.l HWIO_TXC_PP_PHASE_OVR_VAL_A0_ADDR A:0x4384084
y.create.l HWIO_TXC_DP_ENV_OVR_VAL_A0_ADDR A:0x4384088
y.create.l HWIO_TXC_EP_ENV_OVR_VAL_A0_ADDR A:0x438408c
y.create.l HWIO_TXC_EP_ENV_OVR_VAL_SET2_A0_ADDR A:0x4384090
y.create.l HWIO_TXC_DP_ROT_PHASE_INC_A0_ADDR A:0x43840a0
y.create.l HWIO_TXC_DP_ROT_PHASE_INC_SET2_A0_ADDR A:0x43840a4
y.create.l HWIO_TXC_DP_ROT_PHASE_INIT_A0_ADDR A:0x43840a8
y.create.l HWIO_TXC_DP_ROT_PHASE_INIT_SET2_A0_ADDR A:0x43840ac
y.create.l HWIO_TXC_DP_ROT_PHASE_SHIFT_A0_ADDR A:0x43840b0
y.create.l HWIO_TXC_DP_ROT_PHASE_SHIFT_SET2_A0_ADDR A:0x43840b4
y.create.l HWIO_TXC_DP_IQ_GAIN_A0_ADDR A:0x43840b8
y.create.l HWIO_TXC_DP_IQ_GAIN_SET2_A0_ADDR A:0x43840bc
y.create.l HWIO_TXC_DP_IQMC_A0_ADDR A:0x43840d0
y.create.l HWIO_TXC_DP_IQMC_SET2_A0_ADDR A:0x43840d4
y.create.l HWIO_TXC_DP_PEQ1_A0_ADDR A:0x43840d8
y.create.l HWIO_TXC_DP_PEQ1_SET2_A0_ADDR A:0x43840dc
y.create.l HWIO_TXC_DP_PEQ2_A0_ADDR A:0x43840f0
y.create.l HWIO_TXC_DP_PEQ2_SET2_A0_ADDR A:0x43840f4
y.create.l HWIO_TXC_DP_DCOC_A0_ADDR A:0x43840f8
y.create.l HWIO_TXC_DP_DCOC_SET2_A0_ADDR A:0x43840fc
y.create.l HWIO_TXC_DM1_CFG_A0_ADDR A:0x4384100
y.create.l HWIO_TXC_DP_IQ_GAIN_IMM_A0_ADDR A:0x4384104
y.create.l HWIO_TXC_DP_IQMC_IMM_A0_ADDR A:0x4384108
y.create.l HWIO_TXC_DP_DCOC_IMM_A0_ADDR A:0x438410c
y.create.l HWIO_TXC_DP_PEQ1_Q_A0_ADDR A:0x4384110
y.create.l HWIO_TXC_DP_PEQ1_Q_SET2_A0_ADDR A:0x4384114
y.create.l HWIO_TXC_EP_GAIN_A0_ADDR A:0x4384160
y.create.l HWIO_TXC_EP_GAIN_SET2_A0_ADDR A:0x4384164
y.create.l HWIO_TXC_EP_PEQ1_A0_ADDR A:0x4384168
y.create.l HWIO_TXC_EP_PEQ1_SET2_A0_ADDR A:0x438416c
y.create.l HWIO_TXC_EP_DCOC_A0_ADDR A:0x4384170
y.create.l HWIO_TXC_EP_DCOC_SET2_A0_ADDR A:0x4384174
y.create.l HWIO_TXC_EP_DM2_FINE_TAU_A0_ADDR A:0x4384178
y.create.l HWIO_TXC_EP_DM3_FRAC_TAU_A0_ADDR A:0x438417c
y.create.l HWIO_TXC_PP_GAIN_A0_ADDR A:0x4384180
y.create.l HWIO_TXC_PP_SPILL_A0_ADDR A:0x4384190
y.create.l HWIO_TXC_EP_PEQ2_A0_ADDR A:0x4384198
y.create.l HWIO_TXC_TIMESTAMP_T1_A0_ADDR A:0x43841a0
y.create.l HWIO_TXC_TIMESTAMP_T2_A0_ADDR A:0x43841a8
y.create.l HWIO_TXC_TIMESTAMP_REUSE_A0_ADDR A:0x43841b0
y.create.l HWIO_TXC_SAMPLE_COUNT_A0_ADDR A:0x43841b4
y.create.l HWIO_TXC_SAMPLE_COUNT_CTL_A0_ADDR A:0x43841b8
y.create.l HWIO_TXC_REF_ARM_A0_ADDR A:0x43841c0
y.create.l HWIO_TXC_REF_DWN_FACTOR_A0_ADDR A:0x43841c4
y.create.l HWIO_TXC_REF_NUM_SAMPLES_A0_ADDR A:0x43841c8
y.create.l HWIO_TXC_REF_START_TIME_A0_ADDR A:0x43841cc
y.create.l HWIO_TXC_REF_STATUS_A0_ADDR A:0x43841d0
y.create.l HWIO_TXC_REF_PEAK_POWER_A0_ADDR A:0x43841d4
y.create.l HWIO_TXC_REF_RMS_POWER_M_A0_ADDR A:0x43841d8
y.create.l HWIO_TXC_REF_RMS_POWER_L_A0_ADDR A:0x43841dc
y.create.l HWIO_TXC_REF_MODE_A0_ADDR A:0x43841e0
y.create.l HWIO_TXC_REF_I_GAIN_VAL_A0_ADDR A:0x43841e4
y.create.l HWIO_TXC_REF_Q_GAIN_VAL_A0_ADDR A:0x43841e8
y.create.l HWIO_TXC_REF_POWERCALC_OR_LOG_A0_ADDR A:0x43841ec
y.create.l HWIO_TXC_TESTBUS_SELECT_A0_ADDR A:0x43841f0
y.create.l HWIO_TXC_TEST_BUS_IN_IQ_SWAP_A0_ADDR A:0x43841f4
y.create.l HWIO_TXC_TEST_BUS_OUT_IQ_SWAP_A0_ADDR A:0x43841f8
y.create.l HWIO_TXC_AMAM_PENDING_A0_ADDR A:0x4384220
y.create.l HWIO_TXC_AMPM_PENDING_A0_ADDR A:0x4384224
y.create.l HWIO_TXC_AMAM_PENDING_SET2_A0_ADDR A:0x4384230
y.create.l HWIO_TXC_AMPM_PENDING_SET2_A0_ADDR A:0x4384234
y.create.l HWIO_TXC_AMAM_ACTIVE_A0_ADDR A:0x4384240
y.create.l HWIO_TXC_AMPM_ACTIVE_A0_ADDR A:0x4384244
y.create.l HWIO_TXC_RAMP_ACTIVE_A0_ADDR A:0x438424c
y.create.l HWIO_TXC_REF_POWER_SUM_I_A0_ADDR A:0x43842e0
y.create.l HWIO_TXC_REF_POWER_SUM_Q_A0_ADDR A:0x43842e4
y.create.l HWIO_TXC_REF_POWER_SUM_IQ_M_A0_ADDR A:0x43842e8
y.create.l HWIO_TXC_REF_POWER_SUM_IQ_L_A0_ADDR A:0x43842ec
y.create.l HWIO_TXC_REF_POWER_SUM_QQ_M_A0_ADDR A:0x43842f0
y.create.l HWIO_TXC_REF_POWER_SUM_QQ_L_A0_ADDR A:0x43842f4
y.create.l HWIO_TXC_DP_CFG_LATCHED_A0_ADDR A:0x4384300
y.create.l HWIO_TXC_DP_ENV_SCALE_VAL_LATCHED_A0_ADDR A:0x4384304
y.create.l HWIO_TXC_DP_PHASE_OVR_VAL_LATCHED_A0_ADDR A:0x4384308
y.create.l HWIO_TXC_PP_PHASE_OVR_VAL_LATCHED_A0_ADDR A:0x438430c
y.create.l HWIO_TXC_DP_ENV_OVR_VAL_LATCHED_A0_ADDR A:0x4384310
y.create.l HWIO_TXC_EP_ENV_OVR_VAL_LATCHED_A0_ADDR A:0x4384314
y.create.l HWIO_TXC_DP_ROT_PHASE_INC_LATCHED_A0_ADDR A:0x4384318
y.create.l HWIO_TXC_DP_ROT_PHASE_INIT_LATCHED_A0_ADDR A:0x438431c
y.create.l HWIO_TXC_DP_ROT_PHASE_SHIFT_LATCHED_A0_ADDR A:0x4384320
y.create.l HWIO_TXC_DP_IQ_GAIN_LATCHED_A0_ADDR A:0x4384324
y.create.l HWIO_TXC_DP_IQMC_LATCHED_A0_ADDR A:0x4384328
y.create.l HWIO_TXC_DP_PEQ1_LATCHED_A0_ADDR A:0x438432c
y.create.l HWIO_TXC_DP_PEQ2_LATCHED_A0_ADDR A:0x4384330
y.create.l HWIO_TXC_DP_DCOC_LATCHED_A0_ADDR A:0x4384334
y.create.l HWIO_TXC_DM1_CFG_LATCHED_A0_ADDR A:0x4384338
y.create.l HWIO_TXC_EP_GAIN_LATCHED_A0_ADDR A:0x438433c
y.create.l HWIO_TXC_EP_PEQ1_LATCHED_A0_ADDR A:0x4384340
y.create.l HWIO_TXC_EP_DCOC_LATCHED_A0_ADDR A:0x4384344
y.create.l HWIO_TXC_EP_DM2_FINE_TAU_LATCHED_A0_ADDR A:0x4384348
y.create.l HWIO_TXC_EP_DM3_FRAC_TAU_LATCHED_A0_ADDR A:0x438434c
y.create.l HWIO_TXC_PP_GAIN_LATCHED_A0_ADDR A:0x4384350
y.create.l HWIO_TXC_PP_SPILL_LATCHED_A0_ADDR A:0x4384354
y.create.l HWIO_TXC_EP_PEQ2_LATCHED_A0_ADDR A:0x4384358
y.create.l HWIO_TXC_DP_CFG_2_LATCHED_A0_ADDR A:0x438435c
y.create.l HWIO_TXC_DP_PEQ1_Q_LATCHED_A0_ADDR A:0x4384360
y.create.l HWIO_TXC_MEM_BANK0_ADDR0_ADDR A:0x4388000
y.create.l HWIO_TXC_MEM_BANK0_ADDR1_ADDR A:0x4388004
y.create.l HWIO_TXC_MEM_BANK0_ADDR2_ADDR A:0x4388008
y.create.l HWIO_TXC_MEM_BANK0_ADDR3_ADDR A:0x438800c
y.create.l HWIO_TXC_MEM_BANK1_ADDR0_ADDR A:0x4388400
y.create.l HWIO_TXC_MEM_BANK1_ADDR1_ADDR A:0x4388404
y.create.l HWIO_TXC_MEM_BANK1_ADDR2_ADDR A:0x4388408
y.create.l HWIO_TXC_MEM_BANK1_ADDR3_ADDR A:0x438840c
y.create.l HWIO_TXC_MEM_BANK2_ADDR0_ADDR A:0x4388800
y.create.l HWIO_TXC_MEM_BANK2_ADDR1_ADDR A:0x4388804
y.create.l HWIO_TXC_MEM_BANK2_ADDR2_ADDR A:0x4388808
y.create.l HWIO_TXC_MEM_BANK2_ADDR3_ADDR A:0x438880c
y.create.l HWIO_TXC_MEM_BANK3_ADDR0_ADDR A:0x4388c00
y.create.l HWIO_TXC_MEM_BANK3_ADDR1_ADDR A:0x4388c04
y.create.l HWIO_TXC_MEM_BANK3_ADDR2_ADDR A:0x4388c08
y.create.l HWIO_TXC_MEM_BANK3_ADDR3_ADDR A:0x4388c0c
y.create.l HWIO_TXC_MEM_BANK4_ADDR0_ADDR A:0x4389000
y.create.l HWIO_TXC_MEM_BANK4_ADDR1_ADDR A:0x4389004
y.create.l HWIO_TXC_MEM_BANK4_ADDR2_ADDR A:0x4389008
y.create.l HWIO_TXC_MEM_BANK4_ADDR3_ADDR A:0x438900c
y.create.l HWIO_TXC_MEM_BANK5_ADDR0_ADDR A:0x4389400
y.create.l HWIO_TXC_MEM_BANK5_ADDR1_ADDR A:0x4389404
y.create.l HWIO_TXC_MEM_BANK5_ADDR2_ADDR A:0x4389408
y.create.l HWIO_TXC_MEM_BANK5_ADDR3_ADDR A:0x438940c
y.create.l HWIO_O_TX_TEST_MODE_ADDR A:0x438a000
y.create.l HWIO_O_TX_CLK_CTL_ADDR A:0x438a004
y.create.l HWIO_O_TX_SW_CLK_CTL_ADDR A:0x438a008
y.create.l HWIO_O_TX_CLK_STATUS_REG_ADDR A:0x438a00c
y.create.l HWIO_O_TX_ENCODER_STATUS_ADDR A:0x438a010
y.create.l HWIO_O_TX_HW_IDLE_ADDR A:0x438a014
y.create.l HWIO_O_TX_BUS_TIMEOUT_ADDR A:0x438a018
y.create.l HWIO_O_TX_WMORE_INT_STATUS_ADDR A:0x438a01c
y.create.l HWIO_O_TX_WMORE_INT_CLEAR_ADDR A:0x438a020
y.create.l HWIO_O_TX_WMORE_TX_PWRDWN_ADDR A:0x438a024
y.create.l HWIO_O_TX_L0_DEC_ACK_BITS_ADDR A:0x438a028
y.create.l HWIO_O_TX_L1_DEC_ACK_BITS_ADDR A:0x438a02c
y.create.l HWIO_O_TX_WMORE_CLIP_THR1_ADDR A:0x438a030
y.create.l HWIO_O_TX_WMORE_CLIP_THR2_ADDR A:0x438a034
y.create.l HWIO_O_TX_WMORE_TS2_ADDR A:0x438a038
y.create.l HWIO_O_TX_WMORE_TS1_ADDR A:0x438a03c
y.create.l HWIO_O_TX_WMORE_CLIP_ENABLE_ADDR A:0x438a040
y.create.l HWIO_O_TX_WMORE_NOTCH_ENABLE_ADDR A:0x438a044
y.create.l HWIO_O_TX_WMORE_NOTCH_ALPHA_I_ADDR A:0x438a048
y.create.l HWIO_O_TX_WMORE_NOTCH_ALPHA_Q_ADDR A:0x438a04c
y.create.l HWIO_O_TX_WMORE_NOTCH_BETA_ADDR A:0x438a050
y.create.l HWIO_O_TX_WMORE_NOTCH_TS1_ADDR A:0x438a054
y.create.l HWIO_O_TX_WMORE_IFFT_SIZE_ADDR A:0x438a058
y.create.l HWIO_O_TX_WMORE_STATUS_WORD0_ADDR A:0x438a200
y.create.l HWIO_TX_LTE_WMORE_WORD0_ADDR A:0x438a300
y.create.l HWIO_TX_LTE_WMORE_WORD1_ADDR A:0x438a304
y.create.l HWIO_TX_LTE_WMORE_WORD2_ADDR A:0x438a308
y.create.l HWIO_TX_LTE_WMORE_WORD3_ADDR A:0x438a30c
y.create.l HWIO_TX_LTE_WMORE_WORD4_ADDR A:0x438a310
y.create.l HWIO_TX_LTE_WMORE_WORD5_ADDR A:0x438a314
y.create.l HWIO_TX_LTE_WMORE_WORD6_ADDR A:0x438a318
y.create.l HWIO_TX_LTE_WMORE_WORD7_ADDR A:0x438a31c
y.create.l HWIO_TX_LTE_WMORE_UPPTS_WORD0_ADDR A:0x438a400
y.create.l HWIO_TX_LTE_WMORE_UPPTS_WORD1_ADDR A:0x438a404
y.create.l HWIO_TX_LTE_WMORE_UPPTS_WORD2_ADDR A:0x438a408
y.create.l HWIO_TX_LTE_WMORE_UPPTS_WORD3_ADDR A:0x438a40c
y.create.l HWIO_TX_LTE_WMORE_PRACH_WORD0_ADDR A:0x438a500
y.create.l HWIO_TX_LTE_WMORE_PRACH_WORD1_ADDR A:0x438a504
y.create.l HWIO_TX_LTE_WMORE_PRACH_WORD2_ADDR A:0x438a508
y.create.l HWIO_O_TX_ENC_STATUS_WORD0_ADDR A:0x438a600
y.create.l HWIO_TX_LTE_PUSCH_ENC_WORD0_ADDR A:0x438a700
y.create.l HWIO_TX_LTE_PUSCH_ENC_WORD1_ADDR A:0x438a704
y.create.l HWIO_TX_LTE_PUSCH_ENC_WORD2_ADDR A:0x438a708
y.create.l HWIO_TX_LTE_PUSCH_ENC_WORD3_ADDR A:0x438a70c
y.create.l HWIO_TX_LTE_PUSCH_ENC_WORD4_ADDR A:0x438a710
y.create.l HWIO_O_TX_MOD_STATUS_WORD0_ADDR A:0x438a800
y.create.l HWIO_TX_LTE_PUSCH_MOD_WORD0_ADDR A:0x438a900
y.create.l HWIO_TX_LTE_PUSCH_MOD_WORD1_ADDR A:0x438a904
y.create.l HWIO_TX_LTE_PUSCH_MOD_WORD2_ADDR A:0x438a908
y.create.l HWIO_TX_LTE_PUSCH_MOD_WORD3_ADDR A:0x438a90c
y.create.l HWIO_TX_LTE_PUSCH_MOD_WORD4_ADDR A:0x438a910
y.create.l HWIO_TX_LTE_PUSCH_MOD_WORD5_ADDR A:0x438a914
y.create.l HWIO_TX_LTE_PUSCH_MOD_WORD6_ADDR A:0x438a918
y.create.l HWIO_TX_LTE_PUSCH_MOD_WORD7_ADDR A:0x438a91c
y.create.l HWIO_TX_LTE_PUSCH_MOD_WORD8_ADDR A:0x438a920
y.create.l HWIO_TX_LTE_PUSCH_MOD_WORD9_ADDR A:0x438a924
y.create.l HWIO_TX_LTE_PUSCH_MOD_WORD10_ADDR A:0x438a928
y.create.l HWIO_TX_LTE_PUSCH_MOD_WORD11_ADDR A:0x438a92c
y.create.l HWIO_TX_LTE_PUSCH_MOD_WORD12_ADDR A:0x438a930
y.create.l HWIO_TX_LTE_PUSCH_MOD_WORD13_ADDR A:0x438a934
y.create.l HWIO_TX_LTE_PUSCH_MOD_WORD14_ADDR A:0x438a938
y.create.l HWIO_TX_LTE_PUSCH_MOD_WORD15_ADDR A:0x438a93c
y.create.l HWIO_TX_LTE_PUSCH_MOD_WORD16_ADDR A:0x438a940
y.create.l HWIO_TX_LTE_PUSCH_MOD_WORD17_ADDR A:0x438a944
y.create.l HWIO_TX_LTE_PUSCH_MOD_WORD18_ADDR A:0x438a948
y.create.l HWIO_TX_LTE_PUSCH_MOD_WORD19_ADDR A:0x438a94c
y.create.l HWIO_TX_LTE_PUSCH_MOD_WORD20_ADDR A:0x438a950
y.create.l HWIO_TX_LTE_PUSCH_MOD_WORD21_ADDR A:0x438a954
y.create.l HWIO_TX_LTE_PUCCH_MOD_WORD0_ADDR A:0x438aa00
y.create.l HWIO_TX_LTE_PUCCH_MOD_WORD1_ADDR A:0x438aa04
y.create.l HWIO_TX_LTE_PUCCH_MOD_WORD2_ADDR A:0x438aa08
y.create.l HWIO_TX_LTE_PUCCH_MOD_WORD3_ADDR A:0x438aa0c
y.create.l HWIO_TX_LTE_PUCCH_MOD_WORD4_ADDR A:0x438aa10
y.create.l HWIO_TX_LTE_PUCCH_MOD_WORD5_ADDR A:0x438aa14
y.create.l HWIO_TX_LTE_PUCCH_MOD_WORD6_ADDR A:0x438aa18
y.create.l HWIO_TX_LTE_PUCCH_MOD_WORD7_ADDR A:0x438aa1c
y.create.l HWIO_TX_LTE_PUCCH_MOD_WORD8_ADDR A:0x438aa20
y.create.l HWIO_TX_LTE_PUCCH_MOD_WORD9_ADDR A:0x438aa24
y.create.l HWIO_TX_LTE_PUCCH_MOD_WORD10_ADDR A:0x438aa28
y.create.l HWIO_TX_LTE_PUCCH_MOD_WORD11_ADDR A:0x438aa2c
y.create.l HWIO_TX_LTE_PUCCH_MOD_WORD12_ADDR A:0x438aa30
y.create.l HWIO_TX_LTE_PUCCH_MOD_WORD13_ADDR A:0x438aa34
y.create.l HWIO_TX_LTE_PRACH_MOD_WORD0_ADDR A:0x438ab00
y.create.l HWIO_TX_LTE_PRACH_MOD_WORD1_ADDR A:0x438ab04
y.create.l HWIO_TX_LTE_PRACH_MOD_WORD2_ADDR A:0x438ab08
y.create.l HWIO_TX_LTE_PRACH_MOD_WORD3_ADDR A:0x438ab0c
y.create.l HWIO_TX_LTE_PRACH_MOD_WORD4_ADDR A:0x438ab10
y.create.l HWIO_TX_LTE_PRACH_MOD_WORD5_ADDR A:0x438ab14
y.create.l HWIO_TX_LTE_UPPTS_MOD_WORD0_ADDR A:0x438ac00
y.create.l HWIO_TX_LTE_UPPTS_MOD_WORD1_ADDR A:0x438ac04
y.create.l HWIO_TX_LTE_UPPTS_MOD_WORD2_ADDR A:0x438ac08
y.create.l HWIO_TX_LTE_UPPTS_MOD_WORD3_ADDR A:0x438ac0c
y.create.l HWIO_TX_LTE_UPPTS_MOD_WORD4_ADDR A:0x438ac10
y.create.l HWIO_TX_LTE_UPPTS_MOD_WORD5_ADDR A:0x438ac14
y.create.l HWIO_TX_LTE_UPPTS_MOD_WORD6_ADDR A:0x438ac18
y.create.l HWIO_TX_LTE_UPPTS_MOD_WORD7_ADDR A:0x438ac1c
y.create.l HWIO_TX_LTE_UPPTS_MOD_WORD8_ADDR A:0x438ac20
y.create.l HWIO_TX_LTE_UPPTS_MOD_WORD9_ADDR A:0x438ac24
y.create.l HWIO_TX_LTE_PUSCH_MOD_ACK_WORD0_ADDR A:0x438ad00
y.create.l HWIO_TX_LTE_PUCCH_MOD_ACK_WORD0_ADDR A:0x438ae00
y.create.l HWIO_RXFE_ENABLE_ADDR A:0x4360000
y.create.l HWIO_RXFE_ADC0_LOGIC_CFG_ADDR A:0x4360004
y.create.l HWIO_RXFE_ADC1_LOGIC_CFG_ADDR A:0x4360008
y.create.l HWIO_RXFE_WB0_ADCMUX_CFG_ADDR A:0x4360018
y.create.l HWIO_RXFE_WB1_ADCMUX_CFG_ADDR A:0x436001c
y.create.l HWIO_RXFE_NB0_WBMUX_CFG_ADDR A:0x436002c
y.create.l HWIO_RXFE_NB1_WBMUX_CFG_ADDR A:0x4360030
y.create.l HWIO_RXFE_NB2_WBMUX_CFG_ADDR A:0x4360034
y.create.l HWIO_RXFE_NB3_WBMUX_CFG_ADDR A:0x4360038
y.create.l HWIO_RXFE_TOP_STATUS_ADDR A:0x436004c
y.create.l HWIO_RXFE_RFIF_UPDATE_CMD_ADDR A:0x4360050
y.create.l HWIO_RXFE_CMNNOTCH_FILT0_CFG0_ADDR A:0x4360054
y.create.l HWIO_RXFE_CMNNOTCH_FILT0_CFG1_ADDR A:0x4360058
y.create.l HWIO_RXFE_CMNNOTCH_FILT1_CFG0_ADDR A:0x436005c
y.create.l HWIO_RXFE_CMNNOTCH_FILT1_CFG1_ADDR A:0x4360060
y.create.l HWIO_RXFE_CMNNOTCH_FILT2_CFG0_ADDR A:0x4360064
y.create.l HWIO_RXFE_CMNNOTCH_FILT2_CFG1_ADDR A:0x4360068
y.create.l HWIO_RXFE_CMNNOTCH_FILT3_CFG0_ADDR A:0x436006c
y.create.l HWIO_RXFE_CMNNOTCH_FILT3_CFG1_ADDR A:0x4360070
y.create.l HWIO_RXFE_CMNNOTCH_FILT01_CFG_ADDR A:0x4360074
y.create.l HWIO_RXFE_CMNNOTCH_FILT23_CFG_ADDR A:0x4360078
y.create.l HWIO_RXFE_ACI_FILT0_CFG_ADDR A:0x436007c
y.create.l HWIO_RXFE_ACI_FILT1_CFG_ADDR A:0x4360080
y.create.l HWIO_RXFE_TOP_SPARE_REG_ADDR A:0x4360084
y.create.l HWIO_RXFE_DBG_ENABLES_ADDR A:0x4360090
y.create.l HWIO_RXFE_DBG_PROBE_CTL_ADDR A:0x4360094
y.create.l HWIO_RXFE_DBG_CMD_ADDR A:0x4360098
y.create.l HWIO_RXFE_PBS_CFG_ADDR A:0x436009c
y.create.l HWIO_RXFE_ADC_TEST1_REG_ADC0_ADDR A:0x4362000
y.create.l HWIO_RXFE_ADC_TEST2_REG_ADC0_ADDR A:0x4362004
y.create.l HWIO_RXFE_ADC_TEST3_REG_ADC0_ADDR A:0x4362008
y.create.l HWIO_RXFE_ADC_CONFIG1_REG_ADC0_ADDR A:0x436200c
y.create.l HWIO_RXFE_ADC_CONFIG2_REG_ADC0_ADDR A:0x4362010
y.create.l HWIO_RXFE_ADC_CONTROL_REG_ADC0_ADDR A:0x4362014
y.create.l HWIO_RXFE_ADC_TEST1_REG_ADC1_ADDR A:0x4362100
y.create.l HWIO_RXFE_ADC_TEST2_REG_ADC1_ADDR A:0x4362104
y.create.l HWIO_RXFE_ADC_TEST3_REG_ADC1_ADDR A:0x4362108
y.create.l HWIO_RXFE_ADC_CONFIG1_REG_ADC1_ADDR A:0x436210c
y.create.l HWIO_RXFE_ADC_CONFIG2_REG_ADC1_ADDR A:0x4362110
y.create.l HWIO_RXFE_ADC_CONTROL_REG_ADC1_ADDR A:0x4362114
y.create.l HWIO_RXFE_WB_TOP_CTL_WB0_ADDR A:0x4364000
y.create.l HWIO_RXFE_WB_TOP_CMD_WB0_ADDR A:0x4364004
y.create.l HWIO_RXFE_WB_TOP_STATUS_WB0_ADDR A:0x4364008
y.create.l HWIO_RXFE_WB_STOPGATE_ACTION_SAMPLE_WB0_ADDR A:0x436400c
y.create.l HWIO_RXFE_WB_TIMINGCTL_STATUS_WB0_ADDR A:0x4364010
y.create.l HWIO_RXFE_WB_MISC_CFG_WB0_ADDR A:0x4364014
y.create.l HWIO_RXFE_WB_WBPWR_CFG_WB0_ADDR A:0x4364018
y.create.l HWIO_RXFE_WB_WBPWR_CMD_WB0_ADDR A:0x436401c
y.create.l HWIO_RXFE_WB_WBPWR_START_ACTION_SAMPLE_WB0_ADDR A:0x4364020
y.create.l HWIO_RXFE_WB_WBPWR_START_MASK_WB0_ADDR A:0x4364024
y.create.l HWIO_RXFE_WB_WBPWR_STOP_ACTION_SAMPLE_WB0_ADDR A:0x4364028
y.create.l HWIO_RXFE_WB_WBPWR_FINAL_ACC_WB0_ADDR A:0x436402c
y.create.l HWIO_RXFE_WB_WBPWR_CURR_ACC_WB0_ADDR A:0x4364030
y.create.l HWIO_RXFE_WB_WBPWR_MAX_ACC_WB0_ADDR A:0x4364034
y.create.l HWIO_RXFE_WB_WBDC_CFG_WB0_ADDR A:0x4364038
y.create.l HWIO_RXFE_WB_WBDC_CMD_WB0_ADDR A:0x436403c
y.create.l HWIO_RXFE_WB_WBDC_START_ACTION_SAMPLE_WB0_ADDR A:0x4364040
y.create.l HWIO_RXFE_WB_WBDC_STOP_ACTION_SAMPLE_WB0_ADDR A:0x4364044
y.create.l HWIO_RXFE_WB_WBDC_UPDATE_ACTION_SAMPLE_WB0_ADDR A:0x4364048
y.create.l HWIO_RXFE_WB_WBDC_UPDATE_DELAY_WB0_ADDR A:0x436404c
y.create.l HWIO_RXFE_WB_WBDC_OVRD_I_WB0_ADDR A:0x4364050
y.create.l HWIO_RXFE_WB_WBDC_OVRD_Q_WB0_ADDR A:0x4364054
y.create.l HWIO_RXFE_WB_WBDC_EST1_CURR_I_WB0_ADDR A:0x4364058
y.create.l HWIO_RXFE_WB_WBDC_EST1_CURR_Q_WB0_ADDR A:0x436405c
y.create.l HWIO_RXFE_WB_WBDC_EST1_PREV_I_WB0_ADDR A:0x4364060
y.create.l HWIO_RXFE_WB_WBDC_EST1_PREV_Q_WB0_ADDR A:0x4364064
y.create.l HWIO_RXFE_WB_WBDC_EST1_LOAD_I_WB0_ADDR A:0x4364068
y.create.l HWIO_RXFE_WB_WBDC_EST1_LOAD_Q_WB0_ADDR A:0x436406c
y.create.l HWIO_RXFE_WB_WBDC_EST2_CURR_I_WB0_ADDR A:0x4364070
y.create.l HWIO_RXFE_WB_WBDC_EST2_CURR_Q_WB0_ADDR A:0x4364074
y.create.l HWIO_RXFE_WB_WBDC_EST2_PREV_I_WB0_ADDR A:0x4364078
y.create.l HWIO_RXFE_WB_WBDC_EST2_PREV_Q_WB0_ADDR A:0x436407c
y.create.l HWIO_RXFE_WB_WBDC_EST2_LOAD_I_WB0_ADDR A:0x4364080
y.create.l HWIO_RXFE_WB_WBDC_EST2_LOAD_Q_WB0_ADDR A:0x4364084
y.create.l HWIO_RXFE_WB_VSRC_CFG_WB0_ADDR A:0x4364088
y.create.l HWIO_RXFE_WB_VSRC_T2BYT1M1_WB0_ADDR A:0x436408c
y.create.l HWIO_RXFE_WB_VSRC_CMD_WB0_ADDR A:0x4364090
y.create.l HWIO_RXFE_WB_VSRC_STATUS_WB0_ADDR A:0x4364094
y.create.l HWIO_RXFE_WB_VSRC_UPDT_ACTION_SAMPLE_WB0_ADDR A:0x4364098
y.create.l HWIO_RXFE_WB_VSRC_CURR_T1BYT2_WB0_ADDR A:0x436409c
y.create.l HWIO_RXFE_WB_VSRC_CURR_T2BYT1M1_WB0_ADDR A:0x43640a0
y.create.l HWIO_RXFE_WB_VSRC_SCTR_LOAD_VALUE_WB0_ADDR A:0x43640a4
y.create.l HWIO_RXFE_WB_VSRC_SCTR_WA_WB0_ADDR A:0x43640a8
y.create.l HWIO_RXFE_WB_VSRC_SCTR_SNAPSHOT_WB0_ADDR A:0x43640ac
y.create.l HWIO_RXFE_WB_VSRC_ACC_SNAPSHOT_WB0_ADDR A:0x43640b0
y.create.l HWIO_RXFE_WB_DEC_FILT_CFG_WB0_ADDR A:0x43640b4
y.create.l HWIO_RXFE_WB_IQMC_CFG0_WB0_ADDR A:0x43640b8
y.create.l HWIO_RXFE_WB_IQMC_CFG1_WB0_ADDR A:0x43640bc
y.create.l HWIO_RXFE_WB_IQMC_CURR_VALS_WB0_ADDR A:0x43640c0
y.create.l HWIO_RXFE_WB_IQMC_UPDT_CMD_WB0_ADDR A:0x43640c4
y.create.l HWIO_RXFE_WB_IQMC_UPDT_ACTION_SAMPLE_WB0_ADDR A:0x43640c8
y.create.l HWIO_RXFE_WB_NOTCH_FILT0_CFG0_WB0_ADDR A:0x43640cc
y.create.l HWIO_RXFE_WB_NOTCH_FILT1_CFG0_WB0_ADDR A:0x43640d4
y.create.l HWIO_RXFE_WB_NOTCH_FILT2_CFG0_WB0_ADDR A:0x43640dc
y.create.l HWIO_RXFE_WB_NOTCH_FILT0_CFG1_WB0_ADDR A:0x43640d0
y.create.l HWIO_RXFE_WB_NOTCH_FILT1_CFG1_WB0_ADDR A:0x43640d8
y.create.l HWIO_RXFE_WB_NOTCH_FILT2_CFG1_WB0_ADDR A:0x43640e0
y.create.l HWIO_RXFE_WB_NOTCH_FILT012_CFG_WB0_ADDR A:0x43640e4
y.create.l HWIO_RXFE_WB_SPARE_REG_WB0_ADDR A:0x43640e8
y.create.l HWIO_RXFE_WB_TOP_CTL_WB1_ADDR A:0x4365000
y.create.l HWIO_RXFE_WB_TOP_CMD_WB1_ADDR A:0x4365004
y.create.l HWIO_RXFE_WB_TOP_STATUS_WB1_ADDR A:0x4365008
y.create.l HWIO_RXFE_WB_STOPGATE_ACTION_SAMPLE_WB1_ADDR A:0x436500c
y.create.l HWIO_RXFE_WB_TIMINGCTL_STATUS_WB1_ADDR A:0x4365010
y.create.l HWIO_RXFE_WB_MISC_CFG_WB1_ADDR A:0x4365014
y.create.l HWIO_RXFE_WB_WBPWR_CFG_WB1_ADDR A:0x4365018
y.create.l HWIO_RXFE_WB_WBPWR_CMD_WB1_ADDR A:0x436501c
y.create.l HWIO_RXFE_WB_WBPWR_START_ACTION_SAMPLE_WB1_ADDR A:0x4365020
y.create.l HWIO_RXFE_WB_WBPWR_START_MASK_WB1_ADDR A:0x4365024
y.create.l HWIO_RXFE_WB_WBPWR_STOP_ACTION_SAMPLE_WB1_ADDR A:0x4365028
y.create.l HWIO_RXFE_WB_WBPWR_FINAL_ACC_WB1_ADDR A:0x436502c
y.create.l HWIO_RXFE_WB_WBPWR_CURR_ACC_WB1_ADDR A:0x4365030
y.create.l HWIO_RXFE_WB_WBPWR_MAX_ACC_WB1_ADDR A:0x4365034
y.create.l HWIO_RXFE_WB_WBDC_CFG_WB1_ADDR A:0x4365038
y.create.l HWIO_RXFE_WB_WBDC_CMD_WB1_ADDR A:0x436503c
y.create.l HWIO_RXFE_WB_WBDC_START_ACTION_SAMPLE_WB1_ADDR A:0x4365040
y.create.l HWIO_RXFE_WB_WBDC_STOP_ACTION_SAMPLE_WB1_ADDR A:0x4365044
y.create.l HWIO_RXFE_WB_WBDC_UPDATE_ACTION_SAMPLE_WB1_ADDR A:0x4365048
y.create.l HWIO_RXFE_WB_WBDC_UPDATE_DELAY_WB1_ADDR A:0x436504c
y.create.l HWIO_RXFE_WB_WBDC_OVRD_I_WB1_ADDR A:0x4365050
y.create.l HWIO_RXFE_WB_WBDC_OVRD_Q_WB1_ADDR A:0x4365054
y.create.l HWIO_RXFE_WB_WBDC_EST1_CURR_I_WB1_ADDR A:0x4365058
y.create.l HWIO_RXFE_WB_WBDC_EST1_CURR_Q_WB1_ADDR A:0x436505c
y.create.l HWIO_RXFE_WB_WBDC_EST1_PREV_I_WB1_ADDR A:0x4365060
y.create.l HWIO_RXFE_WB_WBDC_EST1_PREV_Q_WB1_ADDR A:0x4365064
y.create.l HWIO_RXFE_WB_WBDC_EST1_LOAD_I_WB1_ADDR A:0x4365068
y.create.l HWIO_RXFE_WB_WBDC_EST1_LOAD_Q_WB1_ADDR A:0x436506c
y.create.l HWIO_RXFE_WB_WBDC_EST2_CURR_I_WB1_ADDR A:0x4365070
y.create.l HWIO_RXFE_WB_WBDC_EST2_CURR_Q_WB1_ADDR A:0x4365074
y.create.l HWIO_RXFE_WB_WBDC_EST2_PREV_I_WB1_ADDR A:0x4365078
y.create.l HWIO_RXFE_WB_WBDC_EST2_PREV_Q_WB1_ADDR A:0x436507c
y.create.l HWIO_RXFE_WB_WBDC_EST2_LOAD_I_WB1_ADDR A:0x4365080
y.create.l HWIO_RXFE_WB_WBDC_EST2_LOAD_Q_WB1_ADDR A:0x4365084
y.create.l HWIO_RXFE_WB_VSRC_CFG_WB1_ADDR A:0x4365088
y.create.l HWIO_RXFE_WB_VSRC_T2BYT1M1_WB1_ADDR A:0x436508c
y.create.l HWIO_RXFE_WB_VSRC_CMD_WB1_ADDR A:0x4365090
y.create.l HWIO_RXFE_WB_VSRC_STATUS_WB1_ADDR A:0x4365094
y.create.l HWIO_RXFE_WB_VSRC_UPDT_ACTION_SAMPLE_WB1_ADDR A:0x4365098
y.create.l HWIO_RXFE_WB_VSRC_CURR_T1BYT2_WB1_ADDR A:0x436509c
y.create.l HWIO_RXFE_WB_VSRC_CURR_T2BYT1M1_WB1_ADDR A:0x43650a0
y.create.l HWIO_RXFE_WB_VSRC_SCTR_LOAD_VALUE_WB1_ADDR A:0x43650a4
y.create.l HWIO_RXFE_WB_VSRC_SCTR_WA_WB1_ADDR A:0x43650a8
y.create.l HWIO_RXFE_WB_VSRC_SCTR_SNAPSHOT_WB1_ADDR A:0x43650ac
y.create.l HWIO_RXFE_WB_VSRC_ACC_SNAPSHOT_WB1_ADDR A:0x43650b0
y.create.l HWIO_RXFE_WB_DEC_FILT_CFG_WB1_ADDR A:0x43650b4
y.create.l HWIO_RXFE_WB_IQMC_CFG0_WB1_ADDR A:0x43650b8
y.create.l HWIO_RXFE_WB_IQMC_CFG1_WB1_ADDR A:0x43650bc
y.create.l HWIO_RXFE_WB_IQMC_CURR_VALS_WB1_ADDR A:0x43650c0
y.create.l HWIO_RXFE_WB_IQMC_UPDT_CMD_WB1_ADDR A:0x43650c4
y.create.l HWIO_RXFE_WB_IQMC_UPDT_ACTION_SAMPLE_WB1_ADDR A:0x43650c8
y.create.l HWIO_RXFE_WB_NOTCH_FILT0_CFG0_WB1_ADDR A:0x43650cc
y.create.l HWIO_RXFE_WB_NOTCH_FILT1_CFG0_WB1_ADDR A:0x43650d4
y.create.l HWIO_RXFE_WB_NOTCH_FILT2_CFG0_WB1_ADDR A:0x43650dc
y.create.l HWIO_RXFE_WB_NOTCH_FILT0_CFG1_WB1_ADDR A:0x43650d0
y.create.l HWIO_RXFE_WB_NOTCH_FILT1_CFG1_WB1_ADDR A:0x43650d8
y.create.l HWIO_RXFE_WB_NOTCH_FILT2_CFG1_WB1_ADDR A:0x43650e0
y.create.l HWIO_RXFE_WB_NOTCH_FILT012_CFG_WB1_ADDR A:0x43650e4
y.create.l HWIO_RXFE_WB_SPARE_REG_WB1_ADDR A:0x43650e8
y.create.l HWIO_RXFE_NB_TOP_CTL_NB0_ADDR A:0x4370000
y.create.l HWIO_RXFE_NB_GATE_CMD_NB0_ADDR A:0x4370004
y.create.l HWIO_RXFE_NB_GATE_STATUS_NB0_ADDR A:0x4370008
y.create.l HWIO_RXFE_NB_GATE_ACTION_SAMPLE_NB0_ADDR A:0x437000c
y.create.l HWIO_RXFE_NB_TIMINGCTL_STATUS_NB0_ADDR A:0x4370010
y.create.l HWIO_RXFE_NB_CSR_CFG_NB0_ADDR A:0x4370014
y.create.l HWIO_RXFE_NB_CSR_CMD_NB0_ADDR A:0x4370018
y.create.l HWIO_RXFE_NB_CSR_PHASEUPDT_ACTION_SAMPLE_NB0_ADDR A:0x437001c
y.create.l HWIO_RXFE_NB_CSR_FREQUPDT_ACTION_SAMPLE_NB0_ADDR A:0x4370020
y.create.l HWIO_RXFE_NB_CSR_PHASE_OFFSET_NB0_ADDR A:0x4370024
y.create.l HWIO_RXFE_NB_CSR_FREQ_OFFSET_NB0_ADDR A:0x4370028
y.create.l HWIO_RXFE_NB_CSR_CURR_PHASE_OFFSET_NB0_ADDR A:0x437002c
y.create.l HWIO_RXFE_NB_CSR_CURR_FREQ_OFFSET_NB0_ADDR A:0x4370030
y.create.l HWIO_RXFE_NB_FILTERS_CFG_NB0_ADDR A:0x4370034
y.create.l HWIO_RXFE_NB_ICI_COEF0_NB0_ADDR A:0x437003c
y.create.l HWIO_RXFE_NB_ICI_COEF1_NB0_ADDR A:0x4370040
y.create.l HWIO_RXFE_NB_ICI_COEF2_NB0_ADDR A:0x4370044
y.create.l HWIO_RXFE_NB_ICI_COEF3_NB0_ADDR A:0x4370048
y.create.l HWIO_RXFE_NB_ICI_COEF4_NB0_ADDR A:0x437004c
y.create.l HWIO_RXFE_NB_ICI_COEF5_NB0_ADDR A:0x4370050
y.create.l HWIO_RXFE_NB_ICI_COEF6_NB0_ADDR A:0x4370054
y.create.l HWIO_RXFE_NB_ICI_COEF7_NB0_ADDR A:0x4370058
y.create.l HWIO_RXFE_NB_ICI_COEF8_NB0_ADDR A:0x437005c
y.create.l HWIO_RXFE_NB_ICI_COEF9_NB0_ADDR A:0x4370060
y.create.l HWIO_RXFE_NB_GDA_NB0_ADDR A:0x4370068
y.create.l HWIO_RXFE_NB_NBDC_COMPVAL_I_NB0_ADDR A:0x437006c
y.create.l HWIO_RXFE_NB_NBDC_COMPVAL_Q_NB0_ADDR A:0x4370070
y.create.l HWIO_RXFE_NB_NBPWR_CFG_NB0_ADDR A:0x4370074
y.create.l HWIO_RXFE_NB_NBPWR_CMD_NB0_ADDR A:0x4370078
y.create.l HWIO_RXFE_NB_NBPWR_START_ACTION_SAMPLE_NB0_ADDR A:0x437007c
y.create.l HWIO_RXFE_NB_NBPWR_START_MASK_NB0_ADDR A:0x4370080
y.create.l HWIO_RXFE_NB_NBPWR_STOP_ACTION_SAMPLE_NB0_ADDR A:0x4370084
y.create.l HWIO_RXFE_NB_NBPWR_FINAL_ACC_NB0_ADDR A:0x4370088
y.create.l HWIO_RXFE_NB_NBPWR_CURR_ACC_NB0_ADDR A:0x437008c
y.create.l HWIO_RXFE_NB_NBPWR_MAX_ACC_NB0_ADDR A:0x4370090
y.create.l HWIO_RXFE_NB_DVGA_CFG_NB0_ADDR A:0x4370094
y.create.l HWIO_RXFE_NB_DVGA_RXFE_GAIN_NB0_ADDR A:0x4370098
y.create.l HWIO_RXFE_NB_DVGA_OVERRIDE_DVGA_GAIN_NB0_ADDR A:0x437009c
y.create.l HWIO_RXFE_NB_DVGA_CMD_NB0_ADDR A:0x43700a0
y.create.l HWIO_RXFE_NB_DVGA_UPDT_ACTION_SAMPLE_NB0_ADDR A:0x43700a4
y.create.l HWIO_RXFE_NB_DVGA_UPDT_MASK_NB0_ADDR A:0x43700a8
y.create.l HWIO_RXFE_NB_FINAL_BITWIDTHS_CFG_NB0_ADDR A:0x43700ac
y.create.l HWIO_RXFE_NB_FINAL_SWAP_NB0_ADDR A:0x43700dc
y.create.l HWIO_RXFE_NB_WTR_CFG_NB0_ADDR A:0x43700b0
y.create.l HWIO_RXFE_NB_WTR_FUNC_CFG_NB0_ADDR A:0x43700b4
y.create.l HWIO_RXFE_NB_WTR_DBG_CFG0_NB0_ADDR A:0x43700b8
y.create.l HWIO_RXFE_NB_WTR_DBG_CFG1_NB0_ADDR A:0x43700bc
y.create.l HWIO_RXFE_NB_WTR_CMD_NB0_ADDR A:0x43700c0
y.create.l HWIO_RXFE_NB_WTR_START_ACTION_SAMPLE_NB0_ADDR A:0x43700c4
y.create.l HWIO_RXFE_NB_WTR_STOP_ACTION_SAMPLE_NB0_ADDR A:0x43700c8
y.create.l HWIO_RXFE_NB_WTR_STATUS_NB0_ADDR A:0x43700d0
y.create.l HWIO_RXFE_NB_WTR_ADDR_SNAPSHOT_NB0_ADDR A:0x43700d4
y.create.l HWIO_RXFE_NB_SPARE_REG_NB0_ADDR A:0x43700d8
y.create.l HWIO_RXFE_NB_TOP_CTL_NB1_ADDR A:0x4371000
y.create.l HWIO_RXFE_NB_GATE_CMD_NB1_ADDR A:0x4371004
y.create.l HWIO_RXFE_NB_GATE_STATUS_NB1_ADDR A:0x4371008
y.create.l HWIO_RXFE_NB_GATE_ACTION_SAMPLE_NB1_ADDR A:0x437100c
y.create.l HWIO_RXFE_NB_TIMINGCTL_STATUS_NB1_ADDR A:0x4371010
y.create.l HWIO_RXFE_NB_CSR_CFG_NB1_ADDR A:0x4371014
y.create.l HWIO_RXFE_NB_CSR_CMD_NB1_ADDR A:0x4371018
y.create.l HWIO_RXFE_NB_CSR_PHASEUPDT_ACTION_SAMPLE_NB1_ADDR A:0x437101c
y.create.l HWIO_RXFE_NB_CSR_FREQUPDT_ACTION_SAMPLE_NB1_ADDR A:0x4371020
y.create.l HWIO_RXFE_NB_CSR_PHASE_OFFSET_NB1_ADDR A:0x4371024
y.create.l HWIO_RXFE_NB_CSR_FREQ_OFFSET_NB1_ADDR A:0x4371028
y.create.l HWIO_RXFE_NB_CSR_CURR_PHASE_OFFSET_NB1_ADDR A:0x437102c
y.create.l HWIO_RXFE_NB_CSR_CURR_FREQ_OFFSET_NB1_ADDR A:0x4371030
y.create.l HWIO_RXFE_NB_FILTERS_CFG_NB1_ADDR A:0x4371034
y.create.l HWIO_RXFE_NB_ICI_COEF0_NB1_ADDR A:0x437103c
y.create.l HWIO_RXFE_NB_ICI_COEF1_NB1_ADDR A:0x4371040
y.create.l HWIO_RXFE_NB_ICI_COEF2_NB1_ADDR A:0x4371044
y.create.l HWIO_RXFE_NB_ICI_COEF3_NB1_ADDR A:0x4371048
y.create.l HWIO_RXFE_NB_ICI_COEF4_NB1_ADDR A:0x437104c
y.create.l HWIO_RXFE_NB_ICI_COEF5_NB1_ADDR A:0x4371050
y.create.l HWIO_RXFE_NB_ICI_COEF6_NB1_ADDR A:0x4371054
y.create.l HWIO_RXFE_NB_ICI_COEF7_NB1_ADDR A:0x4371058
y.create.l HWIO_RXFE_NB_ICI_COEF8_NB1_ADDR A:0x437105c
y.create.l HWIO_RXFE_NB_ICI_COEF9_NB1_ADDR A:0x4371060
y.create.l HWIO_RXFE_NB_GDA_NB1_ADDR A:0x4371068
y.create.l HWIO_RXFE_NB_NBDC_COMPVAL_I_NB1_ADDR A:0x437106c
y.create.l HWIO_RXFE_NB_NBDC_COMPVAL_Q_NB1_ADDR A:0x4371070
y.create.l HWIO_RXFE_NB_NBPWR_CFG_NB1_ADDR A:0x4371074
y.create.l HWIO_RXFE_NB_NBPWR_CMD_NB1_ADDR A:0x4371078
y.create.l HWIO_RXFE_NB_NBPWR_START_ACTION_SAMPLE_NB1_ADDR A:0x437107c
y.create.l HWIO_RXFE_NB_NBPWR_START_MASK_NB1_ADDR A:0x4371080
y.create.l HWIO_RXFE_NB_NBPWR_STOP_ACTION_SAMPLE_NB1_ADDR A:0x4371084
y.create.l HWIO_RXFE_NB_NBPWR_FINAL_ACC_NB1_ADDR A:0x4371088
y.create.l HWIO_RXFE_NB_NBPWR_CURR_ACC_NB1_ADDR A:0x437108c
y.create.l HWIO_RXFE_NB_NBPWR_MAX_ACC_NB1_ADDR A:0x4371090
y.create.l HWIO_RXFE_NB_DVGA_CFG_NB1_ADDR A:0x4371094
y.create.l HWIO_RXFE_NB_DVGA_RXFE_GAIN_NB1_ADDR A:0x4371098
y.create.l HWIO_RXFE_NB_DVGA_OVERRIDE_DVGA_GAIN_NB1_ADDR A:0x437109c
y.create.l HWIO_RXFE_NB_DVGA_CMD_NB1_ADDR A:0x43710a0
y.create.l HWIO_RXFE_NB_DVGA_UPDT_ACTION_SAMPLE_NB1_ADDR A:0x43710a4
y.create.l HWIO_RXFE_NB_DVGA_UPDT_MASK_NB1_ADDR A:0x43710a8
y.create.l HWIO_RXFE_NB_FINAL_BITWIDTHS_CFG_NB1_ADDR A:0x43710ac
y.create.l HWIO_RXFE_NB_FINAL_SWAP_NB1_ADDR A:0x43710dc
y.create.l HWIO_RXFE_NB_WTR_CFG_NB1_ADDR A:0x43710b0
y.create.l HWIO_RXFE_NB_WTR_FUNC_CFG_NB1_ADDR A:0x43710b4
y.create.l HWIO_RXFE_NB_WTR_DBG_CFG0_NB1_ADDR A:0x43710b8
y.create.l HWIO_RXFE_NB_WTR_DBG_CFG1_NB1_ADDR A:0x43710bc
y.create.l HWIO_RXFE_NB_WTR_CMD_NB1_ADDR A:0x43710c0
y.create.l HWIO_RXFE_NB_WTR_START_ACTION_SAMPLE_NB1_ADDR A:0x43710c4
y.create.l HWIO_RXFE_NB_WTR_STOP_ACTION_SAMPLE_NB1_ADDR A:0x43710c8
y.create.l HWIO_RXFE_NB_WTR_STATUS_NB1_ADDR A:0x43710d0
y.create.l HWIO_RXFE_NB_WTR_ADDR_SNAPSHOT_NB1_ADDR A:0x43710d4
y.create.l HWIO_RXFE_NB_SPARE_REG_NB1_ADDR A:0x43710d8
y.create.l HWIO_RXFE_NB_TOP_CTL_NB2_ADDR A:0x4372000
y.create.l HWIO_RXFE_NB_GATE_CMD_NB2_ADDR A:0x4372004
y.create.l HWIO_RXFE_NB_GATE_STATUS_NB2_ADDR A:0x4372008
y.create.l HWIO_RXFE_NB_GATE_ACTION_SAMPLE_NB2_ADDR A:0x437200c
y.create.l HWIO_RXFE_NB_TIMINGCTL_STATUS_NB2_ADDR A:0x4372010
y.create.l HWIO_RXFE_NB_CSR_CFG_NB2_ADDR A:0x4372014
y.create.l HWIO_RXFE_NB_CSR_CMD_NB2_ADDR A:0x4372018
y.create.l HWIO_RXFE_NB_CSR_PHASEUPDT_ACTION_SAMPLE_NB2_ADDR A:0x437201c
y.create.l HWIO_RXFE_NB_CSR_FREQUPDT_ACTION_SAMPLE_NB2_ADDR A:0x4372020
y.create.l HWIO_RXFE_NB_CSR_PHASE_OFFSET_NB2_ADDR A:0x4372024
y.create.l HWIO_RXFE_NB_CSR_FREQ_OFFSET_NB2_ADDR A:0x4372028
y.create.l HWIO_RXFE_NB_CSR_CURR_PHASE_OFFSET_NB2_ADDR A:0x437202c
y.create.l HWIO_RXFE_NB_CSR_CURR_FREQ_OFFSET_NB2_ADDR A:0x4372030
y.create.l HWIO_RXFE_NB_FILTERS_CFG_NB2_ADDR A:0x4372034
y.create.l HWIO_RXFE_NB_ICI_COEF0_NB2_ADDR A:0x437203c
y.create.l HWIO_RXFE_NB_ICI_COEF1_NB2_ADDR A:0x4372040
y.create.l HWIO_RXFE_NB_ICI_COEF2_NB2_ADDR A:0x4372044
y.create.l HWIO_RXFE_NB_ICI_COEF3_NB2_ADDR A:0x4372048
y.create.l HWIO_RXFE_NB_ICI_COEF4_NB2_ADDR A:0x437204c
y.create.l HWIO_RXFE_NB_ICI_COEF5_NB2_ADDR A:0x4372050
y.create.l HWIO_RXFE_NB_ICI_COEF6_NB2_ADDR A:0x4372054
y.create.l HWIO_RXFE_NB_ICI_COEF7_NB2_ADDR A:0x4372058
y.create.l HWIO_RXFE_NB_ICI_COEF8_NB2_ADDR A:0x437205c
y.create.l HWIO_RXFE_NB_ICI_COEF9_NB2_ADDR A:0x4372060
y.create.l HWIO_RXFE_NB_GDA_NB2_ADDR A:0x4372068
y.create.l HWIO_RXFE_NB_NBDC_COMPVAL_I_NB2_ADDR A:0x437206c
y.create.l HWIO_RXFE_NB_NBDC_COMPVAL_Q_NB2_ADDR A:0x4372070
y.create.l HWIO_RXFE_NB_NBPWR_CFG_NB2_ADDR A:0x4372074
y.create.l HWIO_RXFE_NB_NBPWR_CMD_NB2_ADDR A:0x4372078
y.create.l HWIO_RXFE_NB_NBPWR_START_ACTION_SAMPLE_NB2_ADDR A:0x437207c
y.create.l HWIO_RXFE_NB_NBPWR_START_MASK_NB2_ADDR A:0x4372080
y.create.l HWIO_RXFE_NB_NBPWR_STOP_ACTION_SAMPLE_NB2_ADDR A:0x4372084
y.create.l HWIO_RXFE_NB_NBPWR_FINAL_ACC_NB2_ADDR A:0x4372088
y.create.l HWIO_RXFE_NB_NBPWR_CURR_ACC_NB2_ADDR A:0x437208c
y.create.l HWIO_RXFE_NB_NBPWR_MAX_ACC_NB2_ADDR A:0x4372090
y.create.l HWIO_RXFE_NB_DVGA_CFG_NB2_ADDR A:0x4372094
y.create.l HWIO_RXFE_NB_DVGA_RXFE_GAIN_NB2_ADDR A:0x4372098
y.create.l HWIO_RXFE_NB_DVGA_OVERRIDE_DVGA_GAIN_NB2_ADDR A:0x437209c
y.create.l HWIO_RXFE_NB_DVGA_CMD_NB2_ADDR A:0x43720a0
y.create.l HWIO_RXFE_NB_DVGA_UPDT_ACTION_SAMPLE_NB2_ADDR A:0x43720a4
y.create.l HWIO_RXFE_NB_DVGA_UPDT_MASK_NB2_ADDR A:0x43720a8
y.create.l HWIO_RXFE_NB_FINAL_BITWIDTHS_CFG_NB2_ADDR A:0x43720ac
y.create.l HWIO_RXFE_NB_FINAL_SWAP_NB2_ADDR A:0x43720dc
y.create.l HWIO_RXFE_NB_WTR_CFG_NB2_ADDR A:0x43720b0
y.create.l HWIO_RXFE_NB_WTR_FUNC_CFG_NB2_ADDR A:0x43720b4
y.create.l HWIO_RXFE_NB_WTR_DBG_CFG0_NB2_ADDR A:0x43720b8
y.create.l HWIO_RXFE_NB_WTR_DBG_CFG1_NB2_ADDR A:0x43720bc
y.create.l HWIO_RXFE_NB_WTR_CMD_NB2_ADDR A:0x43720c0
y.create.l HWIO_RXFE_NB_WTR_START_ACTION_SAMPLE_NB2_ADDR A:0x43720c4
y.create.l HWIO_RXFE_NB_WTR_STOP_ACTION_SAMPLE_NB2_ADDR A:0x43720c8
y.create.l HWIO_RXFE_NB_WTR_STATUS_NB2_ADDR A:0x43720d0
y.create.l HWIO_RXFE_NB_WTR_ADDR_SNAPSHOT_NB2_ADDR A:0x43720d4
y.create.l HWIO_RXFE_NB_SPARE_REG_NB2_ADDR A:0x43720d8
y.create.l HWIO_RXFE_NB_TOP_CTL_NB3_ADDR A:0x4373000
y.create.l HWIO_RXFE_NB_GATE_CMD_NB3_ADDR A:0x4373004
y.create.l HWIO_RXFE_NB_GATE_STATUS_NB3_ADDR A:0x4373008
y.create.l HWIO_RXFE_NB_GATE_ACTION_SAMPLE_NB3_ADDR A:0x437300c
y.create.l HWIO_RXFE_NB_TIMINGCTL_STATUS_NB3_ADDR A:0x4373010
y.create.l HWIO_RXFE_NB_CSR_CFG_NB3_ADDR A:0x4373014
y.create.l HWIO_RXFE_NB_CSR_CMD_NB3_ADDR A:0x4373018
y.create.l HWIO_RXFE_NB_CSR_PHASEUPDT_ACTION_SAMPLE_NB3_ADDR A:0x437301c
y.create.l HWIO_RXFE_NB_CSR_FREQUPDT_ACTION_SAMPLE_NB3_ADDR A:0x4373020
y.create.l HWIO_RXFE_NB_CSR_PHASE_OFFSET_NB3_ADDR A:0x4373024
y.create.l HWIO_RXFE_NB_CSR_FREQ_OFFSET_NB3_ADDR A:0x4373028
y.create.l HWIO_RXFE_NB_CSR_CURR_PHASE_OFFSET_NB3_ADDR A:0x437302c
y.create.l HWIO_RXFE_NB_CSR_CURR_FREQ_OFFSET_NB3_ADDR A:0x4373030
y.create.l HWIO_RXFE_NB_FILTERS_CFG_NB3_ADDR A:0x4373034
y.create.l HWIO_RXFE_NB_ICI_COEF0_NB3_ADDR A:0x437303c
y.create.l HWIO_RXFE_NB_ICI_COEF1_NB3_ADDR A:0x4373040
y.create.l HWIO_RXFE_NB_ICI_COEF2_NB3_ADDR A:0x4373044
y.create.l HWIO_RXFE_NB_ICI_COEF3_NB3_ADDR A:0x4373048
y.create.l HWIO_RXFE_NB_ICI_COEF4_NB3_ADDR A:0x437304c
y.create.l HWIO_RXFE_NB_ICI_COEF5_NB3_ADDR A:0x4373050
y.create.l HWIO_RXFE_NB_ICI_COEF6_NB3_ADDR A:0x4373054
y.create.l HWIO_RXFE_NB_ICI_COEF7_NB3_ADDR A:0x4373058
y.create.l HWIO_RXFE_NB_ICI_COEF8_NB3_ADDR A:0x437305c
y.create.l HWIO_RXFE_NB_ICI_COEF9_NB3_ADDR A:0x4373060
y.create.l HWIO_RXFE_NB_GDA_NB3_ADDR A:0x4373068
y.create.l HWIO_RXFE_NB_NBDC_COMPVAL_I_NB3_ADDR A:0x437306c
y.create.l HWIO_RXFE_NB_NBDC_COMPVAL_Q_NB3_ADDR A:0x4373070
y.create.l HWIO_RXFE_NB_NBPWR_CFG_NB3_ADDR A:0x4373074
y.create.l HWIO_RXFE_NB_NBPWR_CMD_NB3_ADDR A:0x4373078
y.create.l HWIO_RXFE_NB_NBPWR_START_ACTION_SAMPLE_NB3_ADDR A:0x437307c
y.create.l HWIO_RXFE_NB_NBPWR_START_MASK_NB3_ADDR A:0x4373080
y.create.l HWIO_RXFE_NB_NBPWR_STOP_ACTION_SAMPLE_NB3_ADDR A:0x4373084
y.create.l HWIO_RXFE_NB_NBPWR_FINAL_ACC_NB3_ADDR A:0x4373088
y.create.l HWIO_RXFE_NB_NBPWR_CURR_ACC_NB3_ADDR A:0x437308c
y.create.l HWIO_RXFE_NB_NBPWR_MAX_ACC_NB3_ADDR A:0x4373090
y.create.l HWIO_RXFE_NB_DVGA_CFG_NB3_ADDR A:0x4373094
y.create.l HWIO_RXFE_NB_DVGA_RXFE_GAIN_NB3_ADDR A:0x4373098
y.create.l HWIO_RXFE_NB_DVGA_OVERRIDE_DVGA_GAIN_NB3_ADDR A:0x437309c
y.create.l HWIO_RXFE_NB_DVGA_CMD_NB3_ADDR A:0x43730a0
y.create.l HWIO_RXFE_NB_DVGA_UPDT_ACTION_SAMPLE_NB3_ADDR A:0x43730a4
y.create.l HWIO_RXFE_NB_DVGA_UPDT_MASK_NB3_ADDR A:0x43730a8
y.create.l HWIO_RXFE_NB_FINAL_BITWIDTHS_CFG_NB3_ADDR A:0x43730ac
y.create.l HWIO_RXFE_NB_FINAL_SWAP_NB3_ADDR A:0x43730dc
y.create.l HWIO_RXFE_NB_WTR_CFG_NB3_ADDR A:0x43730b0
y.create.l HWIO_RXFE_NB_WTR_FUNC_CFG_NB3_ADDR A:0x43730b4
y.create.l HWIO_RXFE_NB_WTR_DBG_CFG0_NB3_ADDR A:0x43730b8
y.create.l HWIO_RXFE_NB_WTR_DBG_CFG1_NB3_ADDR A:0x43730bc
y.create.l HWIO_RXFE_NB_WTR_CMD_NB3_ADDR A:0x43730c0
y.create.l HWIO_RXFE_NB_WTR_START_ACTION_SAMPLE_NB3_ADDR A:0x43730c4
y.create.l HWIO_RXFE_NB_WTR_STOP_ACTION_SAMPLE_NB3_ADDR A:0x43730c8
y.create.l HWIO_RXFE_NB_WTR_STATUS_NB3_ADDR A:0x43730d0
y.create.l HWIO_RXFE_NB_WTR_ADDR_SNAPSHOT_NB3_ADDR A:0x43730d4
y.create.l HWIO_RXFE_NB_SPARE_REG_NB3_ADDR A:0x43730d8
y.create.l HWIO_RXFE_WRTR0_CFG0_ADDR A:0x437f000
y.create.l HWIO_RXFE_WRTR1_CFG0_ADDR A:0x437f008
y.create.l HWIO_RXFE_WRTR2_CFG0_ADDR A:0x437f010
y.create.l HWIO_RXFE_WRTR3_CFG0_ADDR A:0x437f018
y.create.l HWIO_RXFE_WRTR0_CFG1_ADDR A:0x437f004
y.create.l HWIO_RXFE_WRTR1_CFG1_ADDR A:0x437f00c
y.create.l HWIO_RXFE_WRTR2_CFG1_ADDR A:0x437f014
y.create.l HWIO_RXFE_WRTR3_CFG1_ADDR A:0x437f01c
y.create.l HWIO_RXFE_WRTR_XFER_CTL_ADDR A:0x437f040
y.create.l HWIO_RXFE_BRDG_CTL_ADDR A:0x437f044
y.create.l HWIO_RXFE_BRDG_STATUS_ADDR A:0x437f048
y.create.l HWIO_RXFE_BRDG_CLEAR_ADDR A:0x437f04c
y.create.l HWIO_RXFE_BRDG_ARB_PRI_ADDR A:0x437f050
y.create.l HWIO_RXFE_BRDG_AXI_PRI_ADDR A:0x437f054
y.create.l HWIO_RXFE_BRDG_AXI_IDLE_CNT0_ADDR A:0x437f058
y.create.l HWIO_RXFE_BRDG_AXI_IDLE_CNT1_ADDR A:0x437f060
y.create.l HWIO_RXFE_BRDG_AXI_IDLE_CNT2_ADDR A:0x437f068
y.create.l HWIO_RXFE_BRDG_AXI_IDLE_CNT3_ADDR A:0x437f070
y.create.l HWIO_DEMBACK_EN_ADDR A:0x4340000
y.create.l HWIO_DEMBACK_MODE_SEL_ADDR A:0x4340004
y.create.l HWIO_DEMBACK_AHB_ERR_ADDR A:0x4340008
y.create.l HWIO_DEMBACK_MISC_ERR_DET_ADDR A:0x4340010
y.create.l HWIO_DEMBACK_MISC_ERR_CLR_ADDR A:0x4340014
y.create.l HWIO_DEMBACK_RDR0_XFER_CTL_ADDR A:0x4340100
y.create.l HWIO_DEMBACK_RDR0_CTX0_CFG0_ADDR A:0x4340108
y.create.l HWIO_DEMBACK_RDR0_CTX0_CFG1_ADDR A:0x434010c
y.create.l HWIO_DEMBACK_RDR0_CTX1_CFG0_ADDR A:0x4340110
y.create.l HWIO_DEMBACK_RDR0_CTX1_CFG1_ADDR A:0x4340114
y.create.l HWIO_DEMBACK_RDR0_CTX2_CFG0_ADDR A:0x4340118
y.create.l HWIO_DEMBACK_RDR0_CTX2_CFG1_ADDR A:0x434011c
y.create.l HWIO_DEMBACK_RDR0_CTX3_CFG0_ADDR A:0x4340120
y.create.l HWIO_DEMBACK_RDR0_CTX3_CFG1_ADDR A:0x4340124
y.create.l HWIO_DEMBACK_RDR1_XFER_CTL_ADDR A:0x4340148
y.create.l HWIO_DEMBACK_RDR1_CFG0_ADDR A:0x434014c
y.create.l HWIO_DEMBACK_RDR1_CFG1_ADDR A:0x4340150
y.create.l HWIO_DEMBACK_RDR2_XFER_CTL_ADDR A:0x4340154
y.create.l HWIO_DEMBACK_RDR2_CFG0_ADDR A:0x4340158
y.create.l HWIO_DEMBACK_RDR2_CFG1_ADDR A:0x434015c
y.create.l HWIO_DEMBACK_BRDG_CTL_ADDR A:0x4340190
y.create.l HWIO_DEMBACK_BRDG_STATUS_ADDR A:0x4340194
y.create.l HWIO_DEMBACK_BRDG_CLEAR_ADDR A:0x4340198
y.create.l HWIO_DEMBACK_BRDG_AXI_PRI_ADDR A:0x43401a0
y.create.l HWIO_DEMBACK_DBG_CTL_ADDR A:0x43401ac
y.create.l HWIO_LTE_DBE_PHICH_STATUS_ADDR A:0x4341000
y.create.l HWIO_LTE_DBE_PCFICH_STATUS_ADDR A:0x4341004
y.create.l HWIO_LTE_DBE_SCRAMBLE_SEED_FF_X1_SEED_ADDR A:0x4341008
y.create.l HWIO_LTE_DBE_TESTBUS_ENABLE_ADDR A:0x434100c
y.create.l HWIO_LTE_DBE_TESTBUS_STATUS_ADDR A:0x4341010
y.create.l HWIO_LTE_DBE_PBCH_CMD_COUNT_ADDR A:0x4341014
y.create.l HWIO_LTE_DBE_PDCCH_CMD_COUNT_ADDR A:0x4341018
y.create.l HWIO_LTE_DBE_PDSCH_CMD_COUNT_ADDR A:0x434101c
y.create.l HWIO_LTE_DBE_PBCH_DONE_COUNT_ADDR A:0x4341020
y.create.l HWIO_LTE_DBE_PDCCH_DONE_COUNT_ADDR A:0x4341024
y.create.l HWIO_LTE_DBE_PDSCH_DONE_COUNT_ADDR A:0x4341028
y.create.l HWIO_LTE_CFG_ADDR A:0x434102c
y.create.l HWIO_DBACK_AMP_EST0_0_ADDR A:0x4342000
y.create.l HWIO_DBACK_AMP_EST0_1_ADDR A:0x4342008
y.create.l HWIO_DBACK_AMP_EST0_2_ADDR A:0x4342010
y.create.l HWIO_DBACK_AMP_EST0_3_ADDR A:0x4342018
y.create.l HWIO_DBACK_AMP_EST0_4_ADDR A:0x4342020
y.create.l HWIO_DBACK_AMP_EST0_5_ADDR A:0x4342028
y.create.l HWIO_DBACK_ENG_EST0_0_ADDR A:0x4342004
y.create.l HWIO_DBACK_ENG_EST0_1_ADDR A:0x434200c
y.create.l HWIO_DBACK_ENG_EST0_2_ADDR A:0x4342014
y.create.l HWIO_DBACK_ENG_EST0_3_ADDR A:0x434201c
y.create.l HWIO_DBACK_ENG_EST0_4_ADDR A:0x4342024
y.create.l HWIO_DBACK_ENG_EST0_5_ADDR A:0x434202c
y.create.l HWIO_DBACK_AMP_EST1_0_ADDR A:0x4342030
y.create.l HWIO_DBACK_AMP_EST1_1_ADDR A:0x4342038
y.create.l HWIO_DBACK_AMP_EST1_2_ADDR A:0x4342040
y.create.l HWIO_DBACK_AMP_EST1_3_ADDR A:0x4342048
y.create.l HWIO_DBACK_AMP_EST1_4_ADDR A:0x4342050
y.create.l HWIO_DBACK_AMP_EST1_5_ADDR A:0x4342058
y.create.l HWIO_DBACK_ENG_EST1_0_ADDR A:0x4342034
y.create.l HWIO_DBACK_ENG_EST1_1_ADDR A:0x434203c
y.create.l HWIO_DBACK_ENG_EST1_2_ADDR A:0x4342044
y.create.l HWIO_DBACK_ENG_EST1_3_ADDR A:0x434204c
y.create.l HWIO_DBACK_ENG_EST1_4_ADDR A:0x4342054
y.create.l HWIO_DBACK_ENG_EST1_5_ADDR A:0x434205c
y.create.l HWIO_DBACK_HS_CH0_PART1_DEC_DATA0_ADDR A:0x4342060
y.create.l HWIO_DBACK_HS_CH1_PART1_DEC_DATA0_ADDR A:0x434206c
y.create.l HWIO_DBACK_HS_CH2_PART1_DEC_DATA0_ADDR A:0x4342078
y.create.l HWIO_DBACK_HS_CH3_PART1_DEC_DATA0_ADDR A:0x4342084
y.create.l HWIO_DBACK_HS_CH4_PART1_DEC_DATA0_ADDR A:0x4342090
y.create.l HWIO_DBACK_HS_CH5_PART1_DEC_DATA0_ADDR A:0x434209c
y.create.l HWIO_DBACK_HS_CH6_PART1_DEC_DATA0_ADDR A:0x43420a8
y.create.l HWIO_DBACK_HS_CH7_PART1_DEC_DATA0_ADDR A:0x43420b4
y.create.l HWIO_DBACK_HS_CH8_PART1_DEC_DATA0_ADDR A:0x43420c0
y.create.l HWIO_DBACK_HS_CH9_PART1_DEC_DATA0_ADDR A:0x43420cc
y.create.l HWIO_DBACK_HS_CH0_PART1_DEC_STAT_ADDR A:0x4342064
y.create.l HWIO_DBACK_HS_CH1_PART1_DEC_STAT_ADDR A:0x4342070
y.create.l HWIO_DBACK_HS_CH2_PART1_DEC_STAT_ADDR A:0x434207c
y.create.l HWIO_DBACK_HS_CH3_PART1_DEC_STAT_ADDR A:0x4342088
y.create.l HWIO_DBACK_HS_CH4_PART1_DEC_STAT_ADDR A:0x4342094
y.create.l HWIO_DBACK_HS_CH5_PART1_DEC_STAT_ADDR A:0x43420a0
y.create.l HWIO_DBACK_HS_CH6_PART1_DEC_STAT_ADDR A:0x43420ac
y.create.l HWIO_DBACK_HS_CH7_PART1_DEC_STAT_ADDR A:0x43420b8
y.create.l HWIO_DBACK_HS_CH8_PART1_DEC_STAT_ADDR A:0x43420c4
y.create.l HWIO_DBACK_HS_CH9_PART1_DEC_STAT_ADDR A:0x43420d0
y.create.l HWIO_DBACK_HS_CH0_SLOT1_AE_EST_ADDR A:0x4342068
y.create.l HWIO_DBACK_HS_CH1_SLOT1_AE_EST_ADDR A:0x4342074
y.create.l HWIO_DBACK_HS_CH2_SLOT1_AE_EST_ADDR A:0x4342080
y.create.l HWIO_DBACK_HS_CH3_SLOT1_AE_EST_ADDR A:0x434208c
y.create.l HWIO_DBACK_HS_CH4_SLOT1_AE_EST_ADDR A:0x4342098
y.create.l HWIO_DBACK_HS_CH5_SLOT1_AE_EST_ADDR A:0x43420a4
y.create.l HWIO_DBACK_HS_CH6_SLOT1_AE_EST_ADDR A:0x43420b0
y.create.l HWIO_DBACK_HS_CH7_SLOT1_AE_EST_ADDR A:0x43420bc
y.create.l HWIO_DBACK_HS_CH8_SLOT1_AE_EST_ADDR A:0x43420c8
y.create.l HWIO_DBACK_HS_CH9_SLOT1_AE_EST_ADDR A:0x43420d4
y.create.l HWIO_DBACK_HS_CH0_PART2_DEC_DATA1_ADDR A:0x43420d8
y.create.l HWIO_DBACK_HS_CH1_PART2_DEC_DATA1_ADDR A:0x43420e8
y.create.l HWIO_DBACK_HS_CH2_PART2_DEC_DATA1_ADDR A:0x43420f8
y.create.l HWIO_DBACK_HS_CH3_PART2_DEC_DATA1_ADDR A:0x4342108
y.create.l HWIO_DBACK_HS_CH4_PART2_DEC_DATA1_ADDR A:0x4342118
y.create.l HWIO_DBACK_HS_CH5_PART2_DEC_DATA1_ADDR A:0x4342128
y.create.l HWIO_DBACK_HS_CH6_PART2_DEC_DATA1_ADDR A:0x4342138
y.create.l HWIO_DBACK_HS_CH7_PART2_DEC_DATA1_ADDR A:0x4342148
y.create.l HWIO_DBACK_HS_CH8_PART2_DEC_DATA1_ADDR A:0x4342158
y.create.l HWIO_DBACK_HS_CH9_PART2_DEC_DATA1_ADDR A:0x4342168
y.create.l HWIO_DBACK_HS_CH0_PART2_DEC_STAT_ADDR A:0x43420dc
y.create.l HWIO_DBACK_HS_CH1_PART2_DEC_STAT_ADDR A:0x43420ec
y.create.l HWIO_DBACK_HS_CH2_PART2_DEC_STAT_ADDR A:0x43420fc
y.create.l HWIO_DBACK_HS_CH3_PART2_DEC_STAT_ADDR A:0x434210c
y.create.l HWIO_DBACK_HS_CH4_PART2_DEC_STAT_ADDR A:0x434211c
y.create.l HWIO_DBACK_HS_CH5_PART2_DEC_STAT_ADDR A:0x434212c
y.create.l HWIO_DBACK_HS_CH6_PART2_DEC_STAT_ADDR A:0x434213c
y.create.l HWIO_DBACK_HS_CH7_PART2_DEC_STAT_ADDR A:0x434214c
y.create.l HWIO_DBACK_HS_CH8_PART2_DEC_STAT_ADDR A:0x434215c
y.create.l HWIO_DBACK_HS_CH9_PART2_DEC_STAT_ADDR A:0x434216c
y.create.l HWIO_DBACK_HS_CH0_SLOT2_AE_EST_ADDR A:0x43420e0
y.create.l HWIO_DBACK_HS_CH1_SLOT2_AE_EST_ADDR A:0x43420f0
y.create.l HWIO_DBACK_HS_CH2_SLOT2_AE_EST_ADDR A:0x4342100
y.create.l HWIO_DBACK_HS_CH3_SLOT2_AE_EST_ADDR A:0x4342110
y.create.l HWIO_DBACK_HS_CH4_SLOT2_AE_EST_ADDR A:0x4342120
y.create.l HWIO_DBACK_HS_CH5_SLOT2_AE_EST_ADDR A:0x4342130
y.create.l HWIO_DBACK_HS_CH6_SLOT2_AE_EST_ADDR A:0x4342140
y.create.l HWIO_DBACK_HS_CH7_SLOT2_AE_EST_ADDR A:0x4342150
y.create.l HWIO_DBACK_HS_CH8_SLOT2_AE_EST_ADDR A:0x4342160
y.create.l HWIO_DBACK_HS_CH9_SLOT2_AE_EST_ADDR A:0x4342170
y.create.l HWIO_DBACK_HS_CH0_SLOT3_AE_EST_ADDR A:0x43420e4
y.create.l HWIO_DBACK_HS_CH1_SLOT3_AE_EST_ADDR A:0x43420f4
y.create.l HWIO_DBACK_HS_CH2_SLOT3_AE_EST_ADDR A:0x4342104
y.create.l HWIO_DBACK_HS_CH3_SLOT3_AE_EST_ADDR A:0x4342114
y.create.l HWIO_DBACK_HS_CH4_SLOT3_AE_EST_ADDR A:0x4342124
y.create.l HWIO_DBACK_HS_CH5_SLOT3_AE_EST_ADDR A:0x4342134
y.create.l HWIO_DBACK_HS_CH6_SLOT3_AE_EST_ADDR A:0x4342144
y.create.l HWIO_DBACK_HS_CH7_SLOT3_AE_EST_ADDR A:0x4342154
y.create.l HWIO_DBACK_HS_CH8_SLOT3_AE_EST_ADDR A:0x4342164
y.create.l HWIO_DBACK_HS_CH9_SLOT3_AE_EST_ADDR A:0x4342174
y.create.l HWIO_DBACK_EAGCH_DEC_DATA_ADDR A:0x4342178
y.create.l HWIO_DBACK_EAGCH_DEC_STAT_ADDR A:0x434217c
y.create.l HWIO_DBACK_EAGCH_METRIC_ADDR A:0x4342180
y.create.l HWIO_DBACK_HSSCCH_CTL1_ADDR A:0x4342184
y.create.l HWIO_DBACK_HSSCCH_CTL2_ADDR A:0x4342188
y.create.l HWIO_HS_SCCH_PART2_DECODE_MAP_ADDR A:0x434218c
y.create.l HWIO_DBACK_CH0_UEID_MASK_0_ADDR A:0x4342190
y.create.l HWIO_DBACK_CH1_UEID_MASK_0_ADDR A:0x4342194
y.create.l HWIO_DBACK_CH2_UEID_MASK_0_ADDR A:0x4342198
y.create.l HWIO_DBACK_CH3_UEID_MASK_0_ADDR A:0x434219c
y.create.l HWIO_DBACK_CH4_UEID_MASK_0_ADDR A:0x43421a0
y.create.l HWIO_DBACK_CH5_UEID_MASK_0_ADDR A:0x43421a4
y.create.l HWIO_DBACK_CH6_UEID_MASK_0_ADDR A:0x43421a8
y.create.l HWIO_DBACK_CH7_UEID_MASK_0_ADDR A:0x43421ac
y.create.l HWIO_DBACK_CH8_UEID_MASK_0_ADDR A:0x43421b0
y.create.l HWIO_DBACK_CH9_UEID_MASK_0_ADDR A:0x43421b4
y.create.l HWIO_DBACK_CH0_UEID_MASK_1_ADDR A:0x43421b8
y.create.l HWIO_DBACK_CH1_UEID_MASK_1_ADDR A:0x43421bc
y.create.l HWIO_DBACK_CH2_UEID_MASK_1_ADDR A:0x43421c0
y.create.l HWIO_DBACK_CH3_UEID_MASK_1_ADDR A:0x43421c4
y.create.l HWIO_DBACK_CH4_UEID_MASK_1_ADDR A:0x43421c8
y.create.l HWIO_DBACK_CH5_UEID_MASK_1_ADDR A:0x43421cc
y.create.l HWIO_DBACK_CH6_UEID_MASK_1_ADDR A:0x43421d0
y.create.l HWIO_DBACK_CH7_UEID_MASK_1_ADDR A:0x43421d4
y.create.l HWIO_DBACK_CH8_UEID_MASK_1_ADDR A:0x43421d8
y.create.l HWIO_DBACK_CH9_UEID_MASK_1_ADDR A:0x43421dc
y.create.l HWIO_DBACK_HSSCCH_PART1_TRIGGER_ADDR A:0x43421e0
y.create.l HWIO_DBACK_HSSCCH_YAM_THRES_ADDR A:0x43421e4
y.create.l HWIO_DBACK_HSSCCH_PART2_TRIGGER_ADDR A:0x43421e8
y.create.l HWIO_DBACK_HSSCCH_STATUS_ADDR A:0x43421ec
y.create.l HWIO_DBACK_EAGCH_CONFIG_ADDR A:0x43421f0
y.create.l HWIO_DBACK_EAGCH_CTL_ADDR A:0x43421f4
y.create.l HWIO_DBACK_EAGCH_TRIGGER_ADDR A:0x43421f8
y.create.l HWIO_DBACK_EAGCH_RM_PATTERN_0_ADDR A:0x43421fc
y.create.l HWIO_DBACK_EAGCH_RM_PATTERN_1_ADDR A:0x4342200
y.create.l HWIO_DBACK_EAGCH_RM_PATTERN_2_ADDR A:0x4342204
y.create.l HWIO_DBACK_HS_EUL_CTL_CH_RST_ADDR A:0x4342208
y.create.l HWIO_DBACK_NONHS_WCB_SIZE_ADDR A:0x434220c
y.create.l HWIO_DBACK_HS_WCB_SIZE_ADDR A:0x4342210
y.create.l HWIO_DBACK_PART1_INT_STATUS_ADDR A:0x4342214
y.create.l HWIO_DBACK_PART1_INT_CLR_ADDR A:0x4342218
y.create.l HWIO_DBACK_PART1_INT_EN_ADDR A:0x434221c
y.create.l HWIO_DBACK_PART2_INT_STATUS_ADDR A:0x4342220
y.create.l HWIO_DBACK_PART2_INT_CLR_ADDR A:0x4342224
y.create.l HWIO_DBACK_PART2_INT_EN_ADDR A:0x4342228
y.create.l HWIO_DBACK_EAGCH_INT_EN_ADDR A:0x434222c
y.create.l HWIO_DBACK_TEST_MEM_SEL_ADDR A:0x4342230
y.create.l HWIO_DBACK_TEST_BUS_SEL_ADDR A:0x4342234
y.create.l HWIO_DBACK_MEM_ADDR_ADDR A:0x4342238
y.create.l HWIO_DBACK_MEM_DATA0_ADDR A:0x434223c
y.create.l HWIO_DBACK_MEM_DATA1_ADDR A:0x4342240
y.create.l HWIO_DBACK_MEM_DATA2_ADDR A:0x4342244
y.create.l HWIO_DBACK_MEM_DATA3_ADDR A:0x4342248
y.create.l HWIO_DBACK_MEM_DATA4_ADDR A:0x434224c
y.create.l HWIO_T_DBACK_HS_CH0_DEC_DATA0_ADDR A:0x4342400
y.create.l HWIO_T_DBACK_HS_CH1_DEC_DATA0_ADDR A:0x434240c
y.create.l HWIO_T_DBACK_HS_CH2_DEC_DATA0_ADDR A:0x4342418
y.create.l HWIO_T_DBACK_HS_CH3_DEC_DATA0_ADDR A:0x4342424
y.create.l HWIO_T_DBACK_HS_CH0_DEC_DATA1_ADDR A:0x4342404
y.create.l HWIO_T_DBACK_HS_CH1_DEC_DATA1_ADDR A:0x4342410
y.create.l HWIO_T_DBACK_HS_CH2_DEC_DATA1_ADDR A:0x434241c
y.create.l HWIO_T_DBACK_HS_CH3_DEC_DATA1_ADDR A:0x4342428
y.create.l HWIO_T_DBACK_HS_CH0_DEC_STAT_ADDR A:0x4342408
y.create.l HWIO_T_DBACK_HS_CH1_DEC_STAT_ADDR A:0x4342414
y.create.l HWIO_T_DBACK_HS_CH2_DEC_STAT_ADDR A:0x4342420
y.create.l HWIO_T_DBACK_HS_CH3_DEC_STAT_ADDR A:0x434242c
y.create.l HWIO_T_DBACK_EAGCH0_DEC_DATA0_ADDR A:0x4342430
y.create.l HWIO_T_DBACK_EAGCH1_DEC_DATA0_ADDR A:0x4342440
y.create.l HWIO_T_DBACK_EAGCH2_DEC_DATA0_ADDR A:0x4342450
y.create.l HWIO_T_DBACK_EAGCH3_DEC_DATA0_ADDR A:0x4342460
y.create.l HWIO_T_DBACK_EAGCH0_DEC_DATA1_ADDR A:0x4342434
y.create.l HWIO_T_DBACK_EAGCH1_DEC_DATA1_ADDR A:0x4342444
y.create.l HWIO_T_DBACK_EAGCH2_DEC_DATA1_ADDR A:0x4342454
y.create.l HWIO_T_DBACK_EAGCH3_DEC_DATA1_ADDR A:0x4342464
y.create.l HWIO_T_DBACK_EAGCH0_DEC_STAT_ADDR A:0x4342438
y.create.l HWIO_T_DBACK_EAGCH1_DEC_STAT_ADDR A:0x4342448
y.create.l HWIO_T_DBACK_EAGCH2_DEC_STAT_ADDR A:0x4342458
y.create.l HWIO_T_DBACK_EAGCH3_DEC_STAT_ADDR A:0x4342468
y.create.l HWIO_T_DBACK_EAGCH0_METRIC_ADDR A:0x434243c
y.create.l HWIO_T_DBACK_EAGCH1_METRIC_ADDR A:0x434244c
y.create.l HWIO_T_DBACK_EAGCH2_METRIC_ADDR A:0x434245c
y.create.l HWIO_T_DBACK_EAGCH3_METRIC_ADDR A:0x434246c
y.create.l HWIO_T_DBACK_FPACH_DEC_DATA0_ADDR A:0x4342470
y.create.l HWIO_T_DBACK_FPACH_DEC_DATA1_ADDR A:0x4342474
y.create.l HWIO_T_DBACK_FPACH_DEC_STAT_ADDR A:0x4342478
y.create.l HWIO_T_DBACK_TEST_MEM_SEL_ADDR A:0x434247c
y.create.l HWIO_T_DBACK_TEST_BUS_SEL_ADDR A:0x4342480
y.create.l HWIO_T_DBACK_MEM_ADDR_ADDR A:0x4342484
y.create.l HWIO_T_DBACK_MEM_DATA0_ADDR A:0x4342488
y.create.l HWIO_T_DBACK_MEM_DATA1_ADDR A:0x434248c
y.create.l HWIO_T_DBACK_MEM_DATA2_ADDR A:0x4342490
y.create.l HWIO_T_DBACK_MEM_DATA3_ADDR A:0x4342494
y.create.l HWIO_T_DBACK_MEM_DATA4_ADDR A:0x4342498
y.create.l HWIO_T_DBACK_HS_CH0_DC_DEC_DATA0_ADDR A:0x434249c
y.create.l HWIO_T_DBACK_HS_CH1_DC_DEC_DATA0_ADDR A:0x43424a8
y.create.l HWIO_T_DBACK_HS_CH2_DC_DEC_DATA0_ADDR A:0x43424b4
y.create.l HWIO_T_DBACK_HS_CH3_DC_DEC_DATA0_ADDR A:0x43424c0
y.create.l HWIO_T_DBACK_HS_CH0_DC_DEC_DATA1_ADDR A:0x43424a0
y.create.l HWIO_T_DBACK_HS_CH1_DC_DEC_DATA1_ADDR A:0x43424ac
y.create.l HWIO_T_DBACK_HS_CH2_DC_DEC_DATA1_ADDR A:0x43424b8
y.create.l HWIO_T_DBACK_HS_CH3_DC_DEC_DATA1_ADDR A:0x43424c4
y.create.l HWIO_T_DBACK_HS_CH0_DC_DEC_STAT_ADDR A:0x43424a4
y.create.l HWIO_T_DBACK_HS_CH1_DC_DEC_STAT_ADDR A:0x43424b0
y.create.l HWIO_T_DBACK_HS_CH2_DC_DEC_STAT_ADDR A:0x43424bc
y.create.l HWIO_T_DBACK_HS_CH3_DC_DEC_STAT_ADDR A:0x43424c8
y.create.l HWIO_DINT_CFG_ADDR A:0x4342600
y.create.l HWIO_DINT_CH0_CFG_ADDR A:0x4342604
y.create.l HWIO_DINT_CH1_CFG_ADDR A:0x4342608
y.create.l HWIO_DINT_CH2_CFG_ADDR A:0x434260c
y.create.l HWIO_TD_BLOCK_SIZE_ADDR A:0x4342614
y.create.l HWIO_TD_INTLV_CFG_LO_ADDR A:0x4342618
y.create.l HWIO_TD_INTLV_CFG_HI_ADDR A:0x434261c
y.create.l HWIO_TD_INTLV_SIZE_LO_ADDR A:0x4342620
y.create.l HWIO_TD_PUNCT_LO_ADDR A:0x4342624
y.create.l HWIO_TD_PUNCT_HI_ADDR A:0x4342628
y.create.l HWIO_DINT_PKT_OFFSET_ADDR A:0x4342630
y.create.l HWIO_DINT_PKT_CFG_ADDR A:0x4342634
y.create.l HWIO_DINT_TASK_OFFSET_ADDR A:0x4342638
y.create.l HWIO_DINT_TASK_LIST_ADDR A:0x434263c
y.create.l HWIO_TST_SYNC_DINT_ADDR A:0x4342640
y.create.l HWIO_TST_CH0_SYMS_ADDR A:0x4342644
y.create.l HWIO_TST_CH1_SYMS_ADDR A:0x4342648
y.create.l HWIO_TST_CH2_SYMS_ADDR A:0x434264c
y.create.l HWIO_TST_SEL_DINT_ADDR A:0x4342654
y.create.l HWIO_DINT_OTD_CFG_ADDR A:0x4342658
y.create.l HWIO_TST_SYS_TIME_ADDR A:0x4342670
y.create.l HWIO_DEINT_DBG_BUS_CTL_ADDR A:0x4342674
y.create.l HWIO_DEC_CLR_INT_STATUS_ADDR A:0x4342684
y.create.l HWIO_DEINT_CLK_STATUS_ADDR A:0x4342688
y.create.l HWIO_DEC_DONE_INT_STATUS_ADDR A:0x434268c
y.create.l HWIO_DEINT_TASK_STATUS_ADDR A:0x4342690
y.create.l HWIO_DEINT_FRMHYP_STATUS_ADDR A:0x4342694
y.create.l HWIO_DINT_VD_RD_ADDR_ADDR A:0x4342698
y.create.l HWIO_DINT_FCH_CFG0_ADDR A:0x434269c
y.create.l HWIO_DINT_FCH_CFG1_ADDR A:0x43426a0
y.create.l HWIO_DINT_FCH_TRIGGER_ADDR A:0x43426a4
y.create.l HWIO_DINT_FCH_WR_BANK_ADDR A:0x43426a8
y.create.l HWIO_DINT_FCH_EGTH_HYP_CFG0_ADDR A:0x43426ac
y.create.l HWIO_DINT_FCH_EGTH_HYP_CFG1_ADDR A:0x43426b0
y.create.l HWIO_DINT_FCH_EGTH_HYP_CFG2_ADDR A:0x43426b4
y.create.l HWIO_DINT_FCH_EGTH_HYP_CFG3_ADDR A:0x43426b8
y.create.l HWIO_DINT_FCH_QRTR_HYP_CFG0_ADDR A:0x43426bc
y.create.l HWIO_DINT_FCH_QRTR_HYP_CFG1_ADDR A:0x43426c0
y.create.l HWIO_DINT_FCH_QRTR_HYP_CFG2_ADDR A:0x43426c4
y.create.l HWIO_DINT_FCH_QRTR_HYP_CFG3_ADDR A:0x43426c8
y.create.l HWIO_DINT_FCH_HALF_HYP_CFG0_ADDR A:0x43426cc
y.create.l HWIO_DINT_FCH_HALF_HYP_CFG1_ADDR A:0x43426d0
y.create.l HWIO_DINT_FCH_HALF_HYP_CFG2_ADDR A:0x43426d4
y.create.l HWIO_DINT_FCH_HALF_HYP_CFG3_ADDR A:0x43426d8
y.create.l HWIO_DINT_FCH_FULL_HYP_CFG0_ADDR A:0x43426dc
y.create.l HWIO_DINT_FCH_FULL_HYP_CFG1_ADDR A:0x43426e0
y.create.l HWIO_DINT_FCH_FULL_HYP_CFG2_ADDR A:0x43426e4
y.create.l HWIO_DINT_FCH_FULL_HYP_CFG3_ADDR A:0x43426e8
y.create.l HWIO_COMB_FUND_SOFT_DEC_IQ_WR_ADDR A:0x4342900
y.create.l HWIO_C_SYNC_TRIG_REG_ADDR A:0x4342904
y.create.l HWIO_CH0_Q_SOFTDEC_ENABLE_ADDR A:0x4342908
y.create.l HWIO_CH1_CONTROL_ADDR A:0x434290c
y.create.l HWIO_CH2_CONTROL_ADDR A:0x4342910
y.create.l HWIO_CDMA_WIDGET_STATUS0_ADDR A:0x4342914
y.create.l HWIO_RESET_STATUS0_ADDR A:0x4342918
y.create.l HWIO_CDMA_WIDGET_STATUS1_ADDR A:0x434291c
y.create.l HWIO_RESET_STATUS1_ADDR A:0x4342920
y.create.l HWIO_HDR_DINT_STATUS_ADDR A:0x4342c24
y.create.l HWIO_HDR_DINT_DBG_BUS_ADDR A:0x4342c80
y.create.l HWIO_HDR_DINT_CLK_STATUS_ADDR A:0x4342c84
y.create.l HWIO_DEMBACK_BUFF_MODE_ADDR A:0x4344004
y.create.l HWIO_DEMBACK_AHB_MEM_PAGE_ADDR A:0x4344008
y.create.l HWIO_DEMBACK_BUFF_MEM_CMD_ADDR A:0x4344010
y.create.l HWIO_DEMBACK_BUFF_MEM_WR_ADDR A:0x4344014
y.create.l HWIO_DEMBACK_BUFF_MEM_RD_ADDR A:0x4344018
y.create.l HWIO_DEMBACK_DBBUF_RDR0_CFG0_ADDR A:0x4344020
y.create.l HWIO_DEMBACK_DBBUF_RDR1_CFG0_ADDR A:0x434402c
y.create.l HWIO_DEMBACK_DBBUF_RDR2_CFG0_ADDR A:0x4344038
y.create.l HWIO_DEMBACK_DBBUF_RDR3_CFG0_ADDR A:0x4344044
y.create.l HWIO_DEMBACK_DBBUF_RDR0_CFG1_ADDR A:0x4344024
y.create.l HWIO_DEMBACK_DBBUF_RDR1_CFG1_ADDR A:0x4344030
y.create.l HWIO_DEMBACK_DBBUF_RDR2_CFG1_ADDR A:0x434403c
y.create.l HWIO_DEMBACK_DBBUF_RDR3_CFG1_ADDR A:0x4344048
y.create.l HWIO_DEMBACK_DBBUF_RDR0_XFER_CTL_ADDR A:0x4344028
y.create.l HWIO_DEMBACK_DBBUF_RDR1_XFER_CTL_ADDR A:0x4344034
y.create.l HWIO_DEMBACK_DBBUF_RDR2_XFER_CTL_ADDR A:0x4344040
y.create.l HWIO_DEMBACK_DBBUF_RDR3_XFER_CTL_ADDR A:0x434404c
y.create.l HWIO_DEMBACK_DBBUF_WRTR0_CFG0_ADDR A:0x4344080
y.create.l HWIO_DEMBACK_DBBUF_WRTR1_CFG0_ADDR A:0x434408c
y.create.l HWIO_DEMBACK_DBBUF_WRTR2_CFG0_ADDR A:0x4344098
y.create.l HWIO_DEMBACK_DBBUF_WRTR3_CFG0_ADDR A:0x43440a4
y.create.l HWIO_DEMBACK_DBBUF_WRTR0_CFG1_ADDR A:0x4344084
y.create.l HWIO_DEMBACK_DBBUF_WRTR1_CFG1_ADDR A:0x4344090
y.create.l HWIO_DEMBACK_DBBUF_WRTR2_CFG1_ADDR A:0x434409c
y.create.l HWIO_DEMBACK_DBBUF_WRTR3_CFG1_ADDR A:0x43440a8
y.create.l HWIO_DEMBACK_DBBUF_WRTR0_XFER_CTL_ADDR A:0x4344088
y.create.l HWIO_DEMBACK_DBBUF_WRTR1_XFER_CTL_ADDR A:0x4344094
y.create.l HWIO_DEMBACK_DBBUF_WRTR2_XFER_CTL_ADDR A:0x43440a0
y.create.l HWIO_DEMBACK_DBBUF_WRTR3_XFER_CTL_ADDR A:0x43440ac
y.create.l HWIO_DEMBACK_DBBUF_BRDG_CTL_ADDR A:0x4344100
y.create.l HWIO_DEMBACK_DBBUF_BRDG_STATUS_ADDR A:0x4344104
y.create.l HWIO_DEMBACK_DBBUF_BRDG_CLEAR_ADDR A:0x4344108
y.create.l HWIO_DEMBACK_BUFF_TBVD_DECOB_RD_MIN_ADDR A:0x4345000
y.create.l HWIO_DEMBACK_BUFF_TBVD_DECOB_RD_MAX_ADDR A:0x434577c
y.create.l HWIO_DEMBACK_BUFF_SVD_DECOB_RD_MIN_ADDR A:0x4346000
y.create.l HWIO_DEMBACK_BUFF_SVD_DECOB_RD_MAX_ADDR A:0x4346d7c
y.create.l HWIO_SVD_TBVD_CLK_STATUS_REG_ADDR A:0x4348000
y.create.l HWIO_SVD_TBVD_HW_IDLE_ADDR A:0x4348004
y.create.l HWIO_SVD_TBVD_TESTBUS_ENABLE_ADDR A:0x4348008
y.create.l HWIO_SVD_MODE_ADDR A:0x434800c
y.create.l HWIO_SVD_POLY2IJ_ADDR A:0x4348010
y.create.l HWIO_SVD_POLY3IJ_ADDR A:0x4348014
y.create.l HWIO_SVD_POLY3K_ADDR A:0x4348018
y.create.l HWIO_SVD_POLY4IJ_ADDR A:0x434801c
y.create.l HWIO_SVD_POLY4KL_ADDR A:0x4348020
y.create.l HWIO_SVD_TESTCON_ADDR A:0x4348024
y.create.l HWIO_SVD_TESTOUT_ADDR A:0x4348028
y.create.l HWIO_SVD_TEST_MEM_SEL_ADDR A:0x434802c
y.create.l HWIO_SVD_TEST_MEM_ADDR_ADDR A:0x4348030
y.create.l HWIO_SVD_TEST_MEM_WRITE_ADDR A:0x4348034
y.create.l HWIO_SVD_TEST_MEM_READ0_ADDR A:0x4348038
y.create.l HWIO_SVD_TEST_MEM_READ1_ADDR A:0x434803c
y.create.l HWIO_SVD_TEST_MEM_DIN_ADDR A:0x4348040
y.create.l HWIO_TBVD_DEBUG_MEM_CMD_ADDR A:0x4348044
y.create.l HWIO_TBVD_DEBUG_MEM_WR_ADDR A:0x4348048
y.create.l HWIO_TBVD_DEBUG_MEM_RD_ADDR A:0x434804c
y.create.l HWIO_LTE_DEMBACK_SCH_STATUS_WORD0_ADDR A:0x4349000
y.create.l HWIO_LTE_DEMBACK_SCH_SHARED_WORD0_ADDR A:0x4349100
y.create.l HWIO_LTE_DEMBACK_SCH_SHARED_WORD1_ADDR A:0x4349104
y.create.l HWIO_LTE_DEMBACK_SCH_SHARED_WORD2_ADDR A:0x4349108
y.create.l HWIO_LTE_DEMBACK_SCH_SHARED_WORD3_ADDR A:0x434910c
y.create.l HWIO_LTE_DEMBACK_SCH_SHARED_WORD4_ADDR A:0x4349110
y.create.l HWIO_LTE_DEMBACK_SCH_SHARED_WORD5_ADDR A:0x4349114
y.create.l HWIO_PDSCH_HARQ_CFG_WORD0_ADDR A:0x4349200
y.create.l HWIO_PDSCH_HARQ_CFG_WORD1_ADDR A:0x4349204
y.create.l HWIO_PDSCH_HARQ_CFG_WORD2_ADDR A:0x4349208
y.create.l HWIO_PDSCH_HARQ_CFG_WORD3_ADDR A:0x434920c
y.create.l HWIO_PDSCH_HARQ_CFG_WORD4_ADDR A:0x4349210
y.create.l HWIO_PDSCH_HARQ_CFG_WORD5_ADDR A:0x4349214
y.create.l HWIO_PDSCH_HARQ_CFG_WORD6_ADDR A:0x4349218
y.create.l HWIO_PDSCH_HARQ_CFG_WORD7_ADDR A:0x434921c
y.create.l HWIO_PDSCH_HARQ_CFG_WORD8_ADDR A:0x4349220
y.create.l HWIO_LTE_DEMBACK_CCH_STATUS_WORD0_ADDR A:0x434a000
y.create.l HWIO_LTE_DEMBACK_CCH_SHARED_WORD0_ADDR A:0x434a100
y.create.l HWIO_LTE_DEMBACK_CCH_SHARED_WORD1_ADDR A:0x434a104
y.create.l HWIO_LTE_DEMBACK_CCH_SHARED_WORD2_ADDR A:0x434a108
y.create.l HWIO_LTE_DEMBACK_CCH_SHARED_WORD3_ADDR A:0x434a10c
y.create.l HWIO_LTE_DEMBACK_CCH_SHARED_WORD4_ADDR A:0x434a110
y.create.l HWIO_LTE_DEMBACK_CCH_SHARED_WORD5_ADDR A:0x434a114
y.create.l HWIO_LTE_DEMBACK_CCH_SHARED_WORD6_ADDR A:0x434a118
y.create.l HWIO_LTE_DEMBACK_CCH_SHARED_WORD7_ADDR A:0x434a11c
y.create.l HWIO_PDCCH_DEINT_CFG_WORD0_ADDR A:0x434a200
y.create.l HWIO_PDCCH_DEINT_CFG_WORD1_ADDR A:0x434a204
y.create.l HWIO_PDCCH_DEINT_CFG_WORD2_ADDR A:0x434a208
y.create.l HWIO_SYMBOL0_REG_MAP_0_WORD0_ADDR A:0x434a300
y.create.l HWIO_SYMBOL0_REG_MAP_0_WORD1_ADDR A:0x434a304
y.create.l HWIO_SYMBOL0_REG_MAP_0_WORD2_ADDR A:0x434a308
y.create.l HWIO_SYMBOL0_REG_MAP_0_WORD3_ADDR A:0x434a30c
y.create.l HWIO_SYMBOL0_REG_MAP_0_WORD4_ADDR A:0x434a310
y.create.l HWIO_SYMBOL0_REG_MAP_0_WORD5_ADDR A:0x434a314
y.create.l HWIO_SYMBOL0_REG_MAP_0_WORD6_ADDR A:0x434a318
y.create.l HWIO_SYMBOL0_REG_MAP_0_WORD7_ADDR A:0x434a31c
y.create.l HWIO_SYMBOL0_REG_MAP_1_WORD0_ADDR A:0x434a400
y.create.l HWIO_SYMBOL0_REG_MAP_1_WORD1_ADDR A:0x434a404
y.create.l HWIO_SYMBOL0_REG_MAP_1_WORD2_ADDR A:0x434a408
y.create.l HWIO_SYMBOL0_REG_MAP_1_WORD3_ADDR A:0x434a40c
y.create.l HWIO_SYMBOL0_REG_MAP_1_WORD4_ADDR A:0x434a410
y.create.l HWIO_SYMBOL0_REG_MAP_1_WORD5_ADDR A:0x434a414
y.create.l HWIO_SYMBOL0_REG_MAP_1_WORD6_ADDR A:0x434a418
y.create.l HWIO_SYMBOL0_REG_MAP_1_WORD7_ADDR A:0x434a41c
y.create.l HWIO_SYMBOL0_REG_MAP_2_WORD0_ADDR A:0x434a500
y.create.l HWIO_SYMBOL0_REG_MAP_2_WORD1_ADDR A:0x434a504
y.create.l HWIO_SYMBOL0_REG_MAP_2_WORD2_ADDR A:0x434a508
y.create.l HWIO_SYMBOL0_REG_MAP_2_WORD3_ADDR A:0x434a50c
y.create.l HWIO_SYMBOL0_REG_MAP_2_WORD4_ADDR A:0x434a510
y.create.l HWIO_SYMBOL0_REG_MAP_2_WORD5_ADDR A:0x434a514
y.create.l HWIO_SYMBOL0_REG_MAP_2_WORD6_ADDR A:0x434a518
y.create.l HWIO_SYMBOL0_REG_MAP_2_WORD7_ADDR A:0x434a51c
y.create.l HWIO_SYMBOL1_REG_MAP_0_WORD0_ADDR A:0x434a600
y.create.l HWIO_SYMBOL1_REG_MAP_0_WORD1_ADDR A:0x434a604
y.create.l HWIO_SYMBOL1_REG_MAP_0_WORD2_ADDR A:0x434a608
y.create.l HWIO_SYMBOL1_REG_MAP_0_WORD3_ADDR A:0x434a60c
y.create.l HWIO_SYMBOL1_REG_MAP_0_WORD4_ADDR A:0x434a610
y.create.l HWIO_SYMBOL1_REG_MAP_0_WORD5_ADDR A:0x434a614
y.create.l HWIO_SYMBOL1_REG_MAP_0_WORD6_ADDR A:0x434a618
y.create.l HWIO_SYMBOL1_REG_MAP_0_WORD7_ADDR A:0x434a61c
y.create.l HWIO_SYMBOL1_REG_MAP_0_WORD8_ADDR A:0x434a620
y.create.l HWIO_SYMBOL1_REG_MAP_0_WORD9_ADDR A:0x434a624
y.create.l HWIO_SYMBOL1_REG_MAP_0_WORD10_ADDR A:0x434a628
y.create.l HWIO_SYMBOL1_REG_MAP_1_WORD0_ADDR A:0x434a700
y.create.l HWIO_SYMBOL1_REG_MAP_1_WORD1_ADDR A:0x434a704
y.create.l HWIO_SYMBOL1_REG_MAP_1_WORD2_ADDR A:0x434a708
y.create.l HWIO_SYMBOL1_REG_MAP_1_WORD3_ADDR A:0x434a70c
y.create.l HWIO_SYMBOL1_REG_MAP_1_WORD4_ADDR A:0x434a710
y.create.l HWIO_SYMBOL1_REG_MAP_1_WORD5_ADDR A:0x434a714
y.create.l HWIO_SYMBOL1_REG_MAP_1_WORD6_ADDR A:0x434a718
y.create.l HWIO_SYMBOL1_REG_MAP_1_WORD7_ADDR A:0x434a71c
y.create.l HWIO_SYMBOL1_REG_MAP_1_WORD8_ADDR A:0x434a720
y.create.l HWIO_SYMBOL1_REG_MAP_1_WORD9_ADDR A:0x434a724
y.create.l HWIO_SYMBOL1_REG_MAP_1_WORD10_ADDR A:0x434a728
y.create.l HWIO_SYMBOL2_REG_MAP_WORD0_ADDR A:0x434a800
y.create.l HWIO_SYMBOL2_REG_MAP_WORD1_ADDR A:0x434a804
y.create.l HWIO_SYMBOL2_REG_MAP_WORD2_ADDR A:0x434a808
y.create.l HWIO_SYMBOL2_REG_MAP_WORD3_ADDR A:0x434a80c
y.create.l HWIO_SYMBOL2_REG_MAP_WORD4_ADDR A:0x434a810
y.create.l HWIO_SYMBOL2_REG_MAP_WORD5_ADDR A:0x434a814
y.create.l HWIO_SYMBOL2_REG_MAP_WORD6_ADDR A:0x434a818
y.create.l HWIO_SYMBOL2_REG_MAP_WORD7_ADDR A:0x434a81c
y.create.l HWIO_SYMBOL2_REG_MAP_WORD8_ADDR A:0x434a820
y.create.l HWIO_SYMBOL2_REG_MAP_WORD9_ADDR A:0x434a824
y.create.l HWIO_SYMBOL2_REG_MAP_WORD10_ADDR A:0x434a828
y.create.l HWIO_PBCH_DEINT_CFG_WORD0_ADDR A:0x434a900
y.create.l HWIO_PBCH_DEINT_CFG_WORD1_ADDR A:0x434a904
y.create.l HWIO_PBCH_DEINT_CFG_WORD2_ADDR A:0x434a908
y.create.l HWIO_PBCH_DEINT_CFG_WORD3_ADDR A:0x434a90c
y.create.l HWIO_PBCH_DEINT_CFG_WORD4_ADDR A:0x434a910
y.create.l HWIO_PBCH_DEINT_CFG_WORD5_ADDR A:0x434a914
y.create.l HWIO_PBCH_DEINT_CFG_WORD6_ADDR A:0x434a918
y.create.l HWIO_PBCH_DEINT_CFG_WORD7_ADDR A:0x434a91c
y.create.l HWIO_PBCH_DEINT_CFG_WORD8_ADDR A:0x434a920
y.create.l HWIO_PBCH_DEINT_CFG_WORD9_ADDR A:0x434a924
y.create.l HWIO_PBCH_DEINT_CFG_WORD10_ADDR A:0x434a928
y.create.l HWIO_PDCCH_REG_REORDER_WORD0_ADDR A:0x434aa00
y.create.l HWIO_PDCCH_REG_REORDER_WORD1_ADDR A:0x434aa04
y.create.l HWIO_PDCCH_REG_REORDER_WORD2_ADDR A:0x434aa08
y.create.l HWIO_PDCCH_REG_REORDER_WORD3_ADDR A:0x434aa0c
y.create.l HWIO_PDCCH_REG_REORDER_WORD4_ADDR A:0x434aa10
y.create.l HWIO_PBCH_FOH_WORD0_ADDR A:0x434ab00
y.create.l HWIO_PBCH_FOH_WORD1_ADDR A:0x434ab04
y.create.l HWIO_PBCH_FOH_WORD2_ADDR A:0x434ab08
y.create.l HWIO_PDSCH_REENC_TB_CFG_WORD0_ADDR A:0x434b100
y.create.l HWIO_PDSCH_REENC_TB_CFG_WORD1_ADDR A:0x434b104
y.create.l HWIO_PDSCH_REENC_TB_CFG_WORD2_ADDR A:0x434b108
y.create.l HWIO_PDSCH_REENC_CB_WORD0_ADDR A:0x434b200
y.create.l HWIO_PDSCH_REENC_CB_WORD1_ADDR A:0x434b204
y.create.l HWIO_PDSCH_REENC_CB_WORD2_ADDR A:0x434b208
y.create.l HWIO_PBCH_REENC_WORD0_ADDR A:0x434b300
y.create.l HWIO_PBCH_REENC_WORD1_ADDR A:0x434b304
y.create.l HWIO_PBCH_REENC_WORD2_ADDR A:0x434b308
y.create.l HWIO_W_DBACK_HS_SHARED_WORD0_ADDR A:0x434c100
y.create.l HWIO_W_DBACK_HS_SHARED_WORD1_ADDR A:0x434c104
y.create.l HWIO_W_DBACK_HS_SHARED_WORD2_ADDR A:0x434c108
y.create.l HWIO_W_DBACK_HS_SHARED_WORD3_ADDR A:0x434c10c
y.create.l HWIO_W_DBACK_HS_SHARED_WORD4_ADDR A:0x434c110
y.create.l HWIO_W_DBACK_HS_SHARED_WORD5_ADDR A:0x434c114
y.create.l HWIO_W_DBACK_HS_SHARED_WORD6_ADDR A:0x434c118
y.create.l HWIO_W_DBACK_HS_SHARED_WORD7_ADDR A:0x434c11c
y.create.l HWIO_W_DBACK_HS_SHARED_WORD8_ADDR A:0x434c120
y.create.l HWIO_W_DBACK_HS_SHARED_WORD9_ADDR A:0x434c124
y.create.l HWIO_W_DBACK_HS_SHARED_WORD10_ADDR A:0x434c128
y.create.l HWIO_W_DBACK_HS_SHARED_WORD11_ADDR A:0x434c12c
y.create.l HWIO_W_DBACK_HS_SHARED_WORD12_ADDR A:0x434c130
y.create.l HWIO_W_DBACK_HS_SHARED_WORD13_ADDR A:0x434c134
y.create.l HWIO_W_DBACK_HS_SHARED_WORD14_ADDR A:0x434c138
y.create.l HWIO_W_DBACK_HS_SHARED_WORD15_ADDR A:0x434c13c
y.create.l HWIO_W_DBACK_HS_SHARED_WORD16_ADDR A:0x434c140
y.create.l HWIO_W_DBACK_HS_SHARED_WORD17_ADDR A:0x434c144
y.create.l HWIO_W_DBACK_HS_SHARED_WORD18_ADDR A:0x434c148
y.create.l HWIO_W_DBACK_HS_SHARED_WORD19_ADDR A:0x434c14c
y.create.l HWIO_W_DBACK_HS_SHARED_WORD20_ADDR A:0x434c150
y.create.l HWIO_W_DBACK_HS_SHARED_WORD21_ADDR A:0x434c154
y.create.l HWIO_W_DBACK_HS_SHARED_WORD22_ADDR A:0x434c158
y.create.l HWIO_W_DBACK_HS_SHARED_WORD23_ADDR A:0x434c15c
y.create.l HWIO_W_DBACK_HS_SHARED_WORD24_ADDR A:0x434c160
y.create.l HWIO_W_DBACK_HS_SHARED_WORD25_ADDR A:0x434c164
y.create.l HWIO_W_DBACK_HS_SHARED_WORD26_ADDR A:0x434c168
y.create.l HWIO_W_DBACK_HS_SHARED_WORD27_ADDR A:0x434c16c
y.create.l HWIO_W_DBACK_HS_SHARED_WORD28_ADDR A:0x434c170
y.create.l HWIO_W_DBACK_HS_SHARED_WORD29_ADDR A:0x434c174
y.create.l HWIO_W_DBACK_HS_SHARED_WORD30_ADDR A:0x434c178
y.create.l HWIO_W_DBACK_HS_SHARED_WORD31_ADDR A:0x434c17c
y.create.l HWIO_W_DBACK_HS_SHARED_WORD32_ADDR A:0x434c180
y.create.l HWIO_W_DBACK_HS_SHARED_WORD33_ADDR A:0x434c184
y.create.l HWIO_W_DBACK_HS_SHARED_WORD34_ADDR A:0x434c188
y.create.l HWIO_W_DBACK_HS_SHARED_WORD35_ADDR A:0x434c18c
y.create.l HWIO_W_DBACK_HS_SHARED_WORD36_ADDR A:0x434c190
y.create.l HWIO_W_DBACK_HS_SHARED_WORD37_ADDR A:0x434c194
y.create.l HWIO_W_DBACK_HS_SHARED_WORD38_ADDR A:0x434c198
y.create.l HWIO_W_DBACK_HS_SHARED_WORD39_ADDR A:0x434c19c
y.create.l HWIO_W_DBACK_HS_SHARED_WORD40_ADDR A:0x434c1a0
y.create.l HWIO_W_DBACK_HS_SHARED_WORD41_ADDR A:0x434c1a4
y.create.l HWIO_W_DBACK_HS_SHARED_WORD42_ADDR A:0x434c1a8
y.create.l HWIO_W_DBACK_HS_SHARED_WORD43_ADDR A:0x434c1ac
y.create.l HWIO_W_DBACK_HS_SHARED_WORD44_ADDR A:0x434c1b0
y.create.l HWIO_W_DBACK_HS_SHARED_WORD45_ADDR A:0x434c1b4
y.create.l HWIO_W_DBACK_HS_SHARED_WORD46_ADDR A:0x434c1b8
y.create.l HWIO_W_DBACK_HS_SHARED_WORD47_ADDR A:0x434c1bc
y.create.l HWIO_W_DBACK_HS_SHARED_WORD48_ADDR A:0x434c1c0
y.create.l HWIO_W_DBACK_HS_SHARED_WORD49_ADDR A:0x434c1c4
y.create.l HWIO_W_DBACK_HS_SHARED_WORD50_ADDR A:0x434c1c8
y.create.l HWIO_W_DBACK_HS_SHARED_WORD51_ADDR A:0x434c1cc
y.create.l HWIO_W_DBACK_HS_SHARED_WORD52_ADDR A:0x434c1d0
y.create.l HWIO_W_DBACK_HS_SHARED_WORD53_ADDR A:0x434c1d4
y.create.l HWIO_W_DBACK_HS_SHARED_WORD54_ADDR A:0x434c1d8
y.create.l HWIO_W_DBACK_HS_SHARED_WORD55_ADDR A:0x434c1dc
y.create.l HWIO_W_DBACK_HS_SHARED_WORD56_ADDR A:0x434c1e0
y.create.l HWIO_W_DBACK_HS_SHARED_WORD57_ADDR A:0x434c1e4
y.create.l HWIO_W_DBACK_HS_TD_DECIB_WRITER_WORD0_ADDR A:0x434c200
y.create.l HWIO_W_DBACK_HS_TD_DECIB_WRITER_CFG_WORD0_ADDR A:0x434c300
y.create.l HWIO_W_DBACK_HS_TD_DECIB_WRITER_CFG_WORD1_ADDR A:0x434c304
y.create.l HWIO_W_DBACK_HS_TD_DECIB_WRITER_CFG_WORD2_ADDR A:0x434c308
y.create.l HWIO_W_DBACK_HS_TD_DECIB_WRITER_CFG_WORD3_ADDR A:0x434c30c
y.create.l HWIO_W_DBACK_HS_TD_DECIB_WRITER_CFG_WORD4_ADDR A:0x434c310
y.create.l HWIO_W_DBACK_HS_TD_DECIB_WRITER_CFG_WORD5_ADDR A:0x434c314
y.create.l HWIO_W_DBACK_HS_TD_DECIB_WRITER_CFG_WORD6_ADDR A:0x434c318
y.create.l HWIO_W_DBACK_HS_TD_DECIB_WRITER_CFG_WORD7_ADDR A:0x434c31c
y.create.l HWIO_W_DBACK_NONHS_SHARED_WORD0_ADDR A:0x434d100
y.create.l HWIO_W_DBACK_NONHS_SHARED_WORD1_ADDR A:0x434d104
y.create.l HWIO_W_DBACK_NONHS_SHARED_WORD2_ADDR A:0x434d108
y.create.l HWIO_W_DBACK_NONHS_SHARED_WORD3_ADDR A:0x434d10c
y.create.l HWIO_W_DBACK_NONHS_SHARED_WORD4_ADDR A:0x434d110
y.create.l HWIO_W_DBACK_NONHS_SHARED_WORD5_ADDR A:0x434d114
y.create.l HWIO_W_DBACK_NONHS_SHARED_WORD6_ADDR A:0x434d118
y.create.l HWIO_W_DBACK_NONHS_SHARED_WORD7_ADDR A:0x434d11c
y.create.l HWIO_W_DBACK_NONHS_DRM_CFG_WORD0_ADDR A:0x434d200
y.create.l HWIO_W_DBACK_NONHS_DRM_CFG_WORD1_ADDR A:0x434d204
y.create.l HWIO_W_DBACK_NONHS_DRM_CFG_WORD2_ADDR A:0x434d208
y.create.l HWIO_W_DBACK_NONHS_DRM_CFG_WORD3_ADDR A:0x434d20c
y.create.l HWIO_W_DBACK_NONHS_DRM_CFG_WORD4_ADDR A:0x434d210
y.create.l HWIO_W_DBACK_NONHS_DRM_CFG_WORD5_ADDR A:0x434d214
y.create.l HWIO_W_DBACK_NONHS_DRM_CFG_WORD6_ADDR A:0x434d218
y.create.l HWIO_W_DBACK_NONHS_DRM_CFG_WORD7_ADDR A:0x434d21c
y.create.l HWIO_W_DBACK_NONHS_DRM_CFG_WORD8_ADDR A:0x434d220
y.create.l HWIO_W_DBACK_NONHS_DRM_CFG_WORD9_ADDR A:0x434d224
y.create.l HWIO_W_DBACK_NONHS_DRM_CFG_WORD10_ADDR A:0x434d228
y.create.l HWIO_W_DBACK_NONHS_DRM_CFG_WORD11_ADDR A:0x434d22c
y.create.l HWIO_W_DBACK_NONHS_DRM_CFG_WORD12_ADDR A:0x434d230
y.create.l HWIO_W_DBACK_NONHS_DRM_CFG_WORD13_ADDR A:0x434d234
y.create.l HWIO_W_DBACK_NONHS_DRM_CFG_WORD14_ADDR A:0x434d238
y.create.l HWIO_W_DBACK_NONHS_DRM_CFG_WORD15_ADDR A:0x434d23c
y.create.l HWIO_W_DBACK_NONHS_TD_DECIB_WRITER_CFG_WORD0_ADDR A:0x434d300
y.create.l HWIO_W_DBACK_NONHS_TD_DECIB_WRITER_CFG_WORD1_ADDR A:0x434d304
y.create.l HWIO_T_DBACK_SHARED_WORD0_ADDR A:0x434e100
y.create.l HWIO_T_DBACK_SHARED_WORD1_ADDR A:0x434e104
y.create.l HWIO_T_DBACK_SHARED_WORD2_ADDR A:0x434e108
y.create.l HWIO_T_DBACK_SHARED_WORD3_ADDR A:0x434e10c
y.create.l HWIO_T_DBACK_SHARED_WORD4_ADDR A:0x434e110
y.create.l HWIO_T_DBACK_SHARED_WORD5_ADDR A:0x434e114
y.create.l HWIO_T_DBACK_SHARED_WORD6_ADDR A:0x434e118
y.create.l HWIO_T_DBACK_SHARED_WORD7_ADDR A:0x434e11c
y.create.l HWIO_T_DBACK_SHARED_WORD8_ADDR A:0x434e120
y.create.l HWIO_T_DBACK_SHARED_WORD9_ADDR A:0x434e124
y.create.l HWIO_T_DBACK_SHARED_WORD10_ADDR A:0x434e128
y.create.l HWIO_T_DBACK_SHARED_WORD11_ADDR A:0x434e12c
y.create.l HWIO_T_DBACK_SHARED_WORD12_ADDR A:0x434e130
y.create.l HWIO_T_DBACK_SHARED_WORD13_ADDR A:0x434e134
y.create.l HWIO_T_DBACK_SHARED_WORD14_ADDR A:0x434e138
y.create.l HWIO_T_DBACK_SHARED_WORD15_ADDR A:0x434e13c
y.create.l HWIO_T_DBACK_SHARED_WORD16_ADDR A:0x434e140
y.create.l HWIO_T_DBACK_SHARED_WORD17_ADDR A:0x434e144
y.create.l HWIO_T_DBACK_SHARED_WORD18_ADDR A:0x434e148
y.create.l HWIO_T_DBACK_SHARED_WORD19_ADDR A:0x434e14c
y.create.l HWIO_T_DBACK_SHARED_WORD20_ADDR A:0x434e150
y.create.l HWIO_T_DBACK_SHARED_WORD21_ADDR A:0x434e154
y.create.l HWIO_T_DBACK_SHARED_WORD22_ADDR A:0x434e158
y.create.l HWIO_T_DBACK_SHARED_WORD23_ADDR A:0x434e15c
y.create.l HWIO_T_DBACK_SHARED_WORD24_ADDR A:0x434e160
y.create.l HWIO_T_DBACK_SHARED_WORD25_ADDR A:0x434e164
y.create.l HWIO_T_DBACK_SHARED_WORD26_ADDR A:0x434e168
y.create.l HWIO_T_DBACK_SHARED_WORD27_ADDR A:0x434e16c
y.create.l HWIO_T_DBACK_SHARED_WORD28_ADDR A:0x434e170
y.create.l HWIO_T_DBACK_SHARED_WORD29_ADDR A:0x434e174
y.create.l HWIO_T_DBACK_SHARED_WORD30_ADDR A:0x434e178
y.create.l HWIO_T_DBACK_SHARED_WORD31_ADDR A:0x434e17c
y.create.l HWIO_T_DBACK_SHARED_WORD32_ADDR A:0x434e180
y.create.l HWIO_T_DBACK_SHARED_WORD33_ADDR A:0x434e184
y.create.l HWIO_T_DBACK_SHARED_WORD34_ADDR A:0x434e188
y.create.l HWIO_T_DBACK_SHARED_WORD35_ADDR A:0x434e18c
y.create.l HWIO_T_DBACK_SHARED_WORD36_ADDR A:0x434e190
y.create.l HWIO_T_DBACK_SHARED_WORD37_ADDR A:0x434e194
y.create.l HWIO_T_DBACK_SHARED_WORD38_ADDR A:0x434e198
y.create.l HWIO_T_DBACK_NONHS_DRM_CFG_WORD0_ADDR A:0x434e200
y.create.l HWIO_T_DBACK_NONHS_DRM_CFG_WORD1_ADDR A:0x434e204
y.create.l HWIO_T_DBACK_NONHS_DRM_CFG_WORD2_ADDR A:0x434e208
y.create.l HWIO_T_DBACK_NONHS_DRM_CFG_WORD3_ADDR A:0x434e20c
y.create.l HWIO_T_DBACK_NONHS_DRM_CFG_WORD4_ADDR A:0x434e210
y.create.l HWIO_T_DBACK_NONHS_DRM_CFG_WORD5_ADDR A:0x434e214
y.create.l HWIO_T_DBACK_NONHS_DRM_CFG_WORD6_ADDR A:0x434e218
y.create.l HWIO_T_DBACK_NONHS_DRM_CFG_WORD7_ADDR A:0x434e21c
y.create.l HWIO_T_DBACK_NONHS_DRM_CFG_WORD8_ADDR A:0x434e220
y.create.l HWIO_T_DBACK_NONHS_DRM_CFG_WORD9_ADDR A:0x434e224
y.create.l HWIO_T_DBACK_NONHS_DRM_CFG_WORD10_ADDR A:0x434e228
y.create.l HWIO_T_DBACK_NONHS_DRM_CFG_WORD11_ADDR A:0x434e22c
y.create.l HWIO_T_DBACK_NONHS_DRM_CFG_WORD12_ADDR A:0x434e230
y.create.l HWIO_T_DBACK_NONHS_DRM_CFG_WORD13_ADDR A:0x434e234
y.create.l HWIO_T_DBACK_NONHS_DRM_CFG_WORD14_ADDR A:0x434e238
y.create.l HWIO_T_DBACK_NONHS_DRM_CFG_WORD15_ADDR A:0x434e23c
y.create.l HWIO_T_DBACK_NONHS_DRM_CFG_WORD16_ADDR A:0x434e240
y.create.l HWIO_T_DBACK_NONHS_DRM_CFG_WORD17_ADDR A:0x434e244
y.create.l HWIO_T_DBACK_NONHS_DRM_CFG_WORD18_ADDR A:0x434e248
y.create.l HWIO_T_DBACK_NONHS_DRM_CFG_WORD19_ADDR A:0x434e24c
y.create.l HWIO_T_DBACK_NONHS_DRM_CFG_WORD20_ADDR A:0x434e250
y.create.l HWIO_T_DBACK_NONHS_DRM_CFG_WORD21_ADDR A:0x434e254
y.create.l HWIO_T_DBACK_NONHS_DRM_CFG_WORD22_ADDR A:0x434e258
y.create.l HWIO_T_DBACK_NONHS_DRM_CFG_WORD23_ADDR A:0x434e25c
y.create.l HWIO_T_DBACK_NONHS_DRM_CFG_WORD24_ADDR A:0x434e260
y.create.l HWIO_T_DBACK_NONHS_DRM_CFG_WORD25_ADDR A:0x434e264
y.create.l HWIO_T_DBACK_NONHS_TD_DECIB_WRITER_CFG_WORD0_ADDR A:0x434e300
y.create.l HWIO_T_DBACK_NONHS_TD_DECIB_WRITER_CFG_WORD1_ADDR A:0x434e304
y.create.l HWIO_T_DBACK_HS_TD_DECIB_WRITER_CFG_WORD0_ADDR A:0x434e400
y.create.l HWIO_T_DBACK_HS_TD_DECIB_WRITER_CFG_WORD1_ADDR A:0x434e404
y.create.l HWIO_T_DBACK_HS_TD_DECIB_WRITER_CFG_WORD2_ADDR A:0x434e408
y.create.l HWIO_T_DBACK_HS_TD_DECIB_WRITER_CFG_WORD3_ADDR A:0x434e40c
y.create.l HWIO_T_DBACK_HS_TD_DECIB_WRITER_CFG_WORD4_ADDR A:0x434e410
y.create.l HWIO_T_DBACK_HS_TD_DECIB_WRITER_CFG_WORD5_ADDR A:0x434e414
y.create.l HWIO_T_DBACK_HS_TD_DECIB_WRITER_CFG_WORD6_ADDR A:0x434e418
y.create.l HWIO_T_DBACK_HS_TD_DECIB_WRITER_CFG_WORD7_ADDR A:0x434e41c
y.create.l HWIO_HDR_DEINT_CFG_WORD0_ADDR A:0x434f100
y.create.l HWIO_HDR_DEINT_CFG_WORD1_ADDR A:0x434f104
y.create.l HWIO_HDR_DEINT_CFG_WORD2_ADDR A:0x434f108
y.create.l HWIO_HDR_DEINT_CFG_WORD3_ADDR A:0x434f10c
y.create.l HWIO_HDR_DEINT_CFG_WORD4_ADDR A:0x434f110
y.create.l HWIO_HDR_DEINT_CFG_WORD5_ADDR A:0x434f114
y.create.l HWIO_HDR_DEINT_CFG_WORD6_ADDR A:0x434f118
y.create.l HWIO_HDR_DEINT_CFG_WORD7_ADDR A:0x434f11c
y.create.l HWIO_HDR_DEINT_CFG_WORD8_ADDR A:0x434f120
y.create.l HWIO_HDR_DEINT_CFG_WORD9_ADDR A:0x434f124
y.create.l HWIO_HDR_DEINT_CFG_WORD10_ADDR A:0x434f128
y.create.l HWIO_HDR_DEINT_CFG_WORD11_ADDR A:0x434f12c
y.create.l HWIO_HDR_DEINT_CFG_WORD12_ADDR A:0x434f130
y.create.l HWIO_HDR_DEINT_CFG_WORD13_ADDR A:0x434f134
y.create.l HWIO_HDR_DEINT_CFG_WORD14_ADDR A:0x434f138
y.create.l HWIO_HDR_DEINT_CFG_WORD15_ADDR A:0x434f13c
y.create.l HWIO_HDR_DEINT_CFG_WORD16_ADDR A:0x434f140
y.create.l HWIO_HDR_DEINT_WORD0_ADDR A:0x434f200
y.create.l HWIO_HDR_DEINT_WORD1_ADDR A:0x434f204
y.create.l HWIO_HDR_DEINT_WORD2_ADDR A:0x434f208
y.create.l HWIO_HDR_DEINT_WORD3_ADDR A:0x434f20c
y.create.l HWIO_HDR_DEINT_WORD4_ADDR A:0x434f210
y.create.l HWIO_HDR_DEINT_WORD5_ADDR A:0x434f214
y.create.l HWIO_HDR_DEINT_WORD6_ADDR A:0x434f218
y.create.l HWIO_HDR_DEINT_WORD7_ADDR A:0x434f21c
y.create.l HWIO_HDR_DEINT_WORD8_ADDR A:0x434f220
y.create.l HWIO_HDR_DEINT_WORD9_ADDR A:0x434f224
y.create.l HWIO_HDR_DEINT_WORD10_ADDR A:0x434f228
y.create.l HWIO_HDR_DEINT_WORD11_ADDR A:0x434f22c
y.create.l HWIO_HDR_DEINT_WORD12_ADDR A:0x434f230
y.create.l HWIO_HDR_DEINT_WORD13_ADDR A:0x434f234
y.create.l HWIO_TBVD_CCH_STATUS_WORD0_ADDR A:0x4350000
y.create.l HWIO_TBVD_CCH_LTE_CFG_WORD0_ADDR A:0x4350100
y.create.l HWIO_TBVD_CCH_LTE_CFG_WORD1_ADDR A:0x4350104
y.create.l HWIO_TBVD_CCH_LTE_CFG_WORD2_ADDR A:0x4350108
y.create.l HWIO_TBVD_CCH_LTE_CFG_WORD3_ADDR A:0x435010c
y.create.l HWIO_TBVD_CCH_LTE_CFG_WORD4_ADDR A:0x4350110
y.create.l HWIO_TBVD_CCH_LTE_CFG_WORD5_ADDR A:0x4350114
y.create.l HWIO_TBVD_CCH_LTE_CFG_WORD6_ADDR A:0x4350118
y.create.l HWIO_TBVD_CCH_LTE_CFG_WORD7_ADDR A:0x435011c
y.create.l HWIO_TBVD_CCH_LTE_CFG_WORD8_ADDR A:0x4350120
y.create.l HWIO_TBVD_CCH_LTE_CFG_WORD9_ADDR A:0x4350124
y.create.l HWIO_TBVD_CCH_LTE_CFG_WORD10_ADDR A:0x4350128
y.create.l HWIO_TBVD_CCH_LTE_CFG_WORD11_ADDR A:0x435012c
y.create.l HWIO_TBVD_CCH_LTE_CFG_WORD12_ADDR A:0x4350130
y.create.l HWIO_TBVD_CCH_LTE_CFG_WORD13_ADDR A:0x4350134
y.create.l HWIO_TBVD_CCH_LTE_CFG_WORD14_ADDR A:0x4350138
y.create.l HWIO_TBVD_CCH_LTE_CFG_WORD15_ADDR A:0x435013c
y.create.l HWIO_TBVD_CCH_LTE_CFG_WORD16_ADDR A:0x4350140
y.create.l HWIO_TBVD_CCH_LTE_CFG_WORD17_ADDR A:0x4350144
y.create.l HWIO_TBVD_CCH_LTE_CFG_WORD18_ADDR A:0x4350148
y.create.l HWIO_TBVD_CCH_LTE_CFG_WORD19_ADDR A:0x435014c
y.create.l HWIO_TBVD_CCH_LTE_PDCCH_WORD0_ADDR A:0x4350200
y.create.l HWIO_TBVD_CCH_LTE_PDCCH_WORD1_ADDR A:0x4350204
y.create.l HWIO_TBVD_CCH_LTE_PDCCH_WORD2_ADDR A:0x4350208
y.create.l HWIO_TBVD_CCH_LTE_PDCCH_WORD3_ADDR A:0x435020c
y.create.l HWIO_TBVD_CCH_LTE_PDCCH_WORD4_ADDR A:0x4350210
y.create.l HWIO_TBVD_CCH_LTE_PDCCH_WORD5_ADDR A:0x4350214
y.create.l HWIO_TBVD_CCH_LTE_PDCCH_WORD6_ADDR A:0x4350218
y.create.l HWIO_DEC_O_CCH_W_NONHS_LTE_PBCH_WORD0_ADDR A:0x4350300
y.create.l HWIO_DEC_O_CCH_W_NONHS_LTE_PBCH_WORD1_ADDR A:0x4350304
y.create.l HWIO_DEC_O_CCH_W_NONHS_LTE_PBCH_WORD2_ADDR A:0x4350308
y.create.l HWIO_DECOB_MEM_BASE_MIN_ADDR A:0x4350500
y.create.l HWIO_DECOB_MEM_BASE_MIN_INT_ADDR A:0x4358500
y.create.l HWIO_DECOB_MEM_BASE_MAX_ADDR A:0x435bdfc
y.create.l HWIO_HARQ_PAGE_START_ADDR A:0x435c000
y.create.l HWIO_HARQ_PAGE_END_ADDR A:0x435fffc
y.create.l HWIO_TDEC_CLK_CTL_ADDR A:0x433c000
y.create.l HWIO_TDEC_SW_CLK_EN_ADDR A:0x433c004
y.create.l HWIO_TDEC_CLK_STATUS_REG_ADDR A:0x433c008
y.create.l HWIO_TDEC_MODE_CTL_ADDR A:0x433c00c
y.create.l HWIO_TD_COMMON_CFG0_ADDR A:0x433c020
y.create.l HWIO_TD_COMMON_CFG1_ADDR A:0x433c024
y.create.l HWIO_TD_COMMON_CFG2_ADDR A:0x433c028
y.create.l HWIO_TD_COMMON_CFG3_ADDR A:0x433c02c
y.create.l HWIO_TD_COMMON_CFG4_ADDR A:0x433c030
y.create.l HWIO_TD_COMMON_CFG5_ADDR A:0x433c034
y.create.l HWIO_TD_COMMON_START_ADDR A:0x433c038
y.create.l HWIO_TD_1X_CFG_ADDR A:0x433c03c
y.create.l HWIO_TD_1X_DECOB_WRITE_PTR_ADDR A:0x433c040
y.create.l HWIO_TDEC_HW_IDLE_ADDR A:0x433c044
y.create.l HWIO_TDEC_PING_STATUS_0_ADDR A:0x433c048
y.create.l HWIO_TDEC_PING_STATUS_1_ADDR A:0x433c04c
y.create.l HWIO_TDEC_PONG_STATUS_0_ADDR A:0x433c050
y.create.l HWIO_TDEC_PONG_STATUS_1_ADDR A:0x433c054
y.create.l HWIO_TDEC_GERAN_STATUS_0_ADDR A:0x433c058
y.create.l HWIO_TDEC_GERAN_STATUS_1_ADDR A:0x433c05c
y.create.l HWIO_TDEC_TESTBUS_ENABLE_ADDR A:0x433c060
y.create.l HWIO_TDEC_TESTBUS_STATUS_ADDR A:0x433c064
y.create.l HWIO_DECIB_PAGE_ID_ADDR A:0x433c068
y.create.l HWIO_TDEC_AHB_ERROR_ADDR_RD_ADDR A:0x433c070
y.create.l HWIO_TEST_CRC_000_RD_ADDR A:0x433c074
y.create.l HWIO_TEST_CRC_001_RD_ADDR A:0x433c078
y.create.l HWIO_TEST_CRC_010_RD_ADDR A:0x433c07c
y.create.l HWIO_TEST_CRC_011_RD_ADDR A:0x433c080
y.create.l HWIO_TEST_CRC_100_RD_ADDR A:0x433c084
y.create.l HWIO_TEST_CRC_101_RD_ADDR A:0x433c088
y.create.l HWIO_TEST_CRC_110_RD_ADDR A:0x433c08c
y.create.l HWIO_TEST_CRC_111_RD_ADDR A:0x433c090
y.create.l HWIO_A2_TEST_SW_CFG_DATA0_ADDR A:0x433c094
y.create.l HWIO_A2_TEST_SW_CFG_DATA1_ADDR A:0x433c098
y.create.l HWIO_A2_TEST_SW_CFG_DATA2_ADDR A:0x433c09c
y.create.l HWIO_A2_TEST_SW_CFG_DATA3_ADDR A:0x433c0a0
y.create.l HWIO_A2_TEST_SW_CFG_DATA4_ADDR A:0x433c0a4
y.create.l HWIO_TD_CFG_STATUS_WORD0_ADDR A:0x433d000
y.create.l HWIO_LTE_CFG_WORD0_ADDR A:0x433d100
y.create.l HWIO_LTE_CFG_WORD1_ADDR A:0x433d104
y.create.l HWIO_LTE_CFG_WORD2_ADDR A:0x433d108
y.create.l HWIO_W_TD_CFG_WORD0_0_ADDR A:0x433d200
y.create.l HWIO_W_TD_CFG_WORD1_0_ADDR A:0x433d204
y.create.l HWIO_W_TD_CFG_WORD2_0_ADDR A:0x433d208
y.create.l HWIO_W_TD_CFG_WORD3_0_ADDR A:0x433d20c
y.create.l HWIO_W_TD_CFG_WORD4_0_ADDR A:0x433d210
y.create.l HWIO_W_TD_CFG_WORD5_0_ADDR A:0x433d214
y.create.l HWIO_W_TD_CFG_WORD6_0_ADDR A:0x433d218
y.create.l HWIO_W_TD_CFG_WORD7_0_ADDR A:0x433d21c
y.create.l HWIO_W_TD_CFG_WORD8_0_ADDR A:0x433d220
y.create.l HWIO_W_TD_CFG_WORD9_0_ADDR A:0x433d224
y.create.l HWIO_W_TD_CFG_WORD0_1_ADDR A:0x433d300
y.create.l HWIO_W_TD_CFG_WORD1_1_ADDR A:0x433d304
y.create.l HWIO_W_TD_CFG_WORD2_1_ADDR A:0x433d308
y.create.l HWIO_W_TD_CFG_WORD3_1_ADDR A:0x433d30c
y.create.l HWIO_W_TD_CFG_WORD4_1_ADDR A:0x433d310
y.create.l HWIO_W_TD_CFG_WORD5_1_ADDR A:0x433d314
y.create.l HWIO_W_TD_CFG_WORD6_1_ADDR A:0x433d318
y.create.l HWIO_W_TD_CFG_WORD7_1_ADDR A:0x433d31c
y.create.l HWIO_W_TD_CFG_WORD8_1_ADDR A:0x433d320
y.create.l HWIO_W_TD_CFG_WORD9_1_ADDR A:0x433d324
y.create.l HWIO_LTE_TRBLK_CFG_WORD0_0_ADDR A:0x433d400
y.create.l HWIO_LTE_TRBLK_CFG_WORD1_0_ADDR A:0x433d404
y.create.l HWIO_LTE_TRBLK_CFG_WORD2_0_ADDR A:0x433d408
y.create.l HWIO_LTE_TRBLK_CFG_WORD3_0_ADDR A:0x433d40c
y.create.l HWIO_LTE_TRBLK_CFG_WORD4_0_ADDR A:0x433d410
y.create.l HWIO_LTE_TRBLK_CFG_WORD5_0_ADDR A:0x433d414
y.create.l HWIO_LTE_TRBLK_CFG_WORD0_1_ADDR A:0x433d500
y.create.l HWIO_LTE_TRBLK_CFG_WORD1_1_ADDR A:0x433d504
y.create.l HWIO_LTE_TRBLK_CFG_WORD2_1_ADDR A:0x433d508
y.create.l HWIO_LTE_TRBLK_CFG_WORD3_1_ADDR A:0x433d50c
y.create.l HWIO_LTE_TRBLK_CFG_WORD4_1_ADDR A:0x433d510
y.create.l HWIO_LTE_TRBLK_CFG_WORD5_1_ADDR A:0x433d514
y.create.l HWIO_GERAN_TD_CFG_WORD0_0_ADDR A:0x433d600
y.create.l HWIO_GERAN_TD_CFG_WORD1_0_ADDR A:0x433d604
y.create.l HWIO_GERAN_TD_CFG_WORD2_0_ADDR A:0x433d608
y.create.l HWIO_GERAN_TD_CFG_WORD3_0_ADDR A:0x433d60c
y.create.l HWIO_GERAN_TD_CFG_WORD0_1_ADDR A:0x433d700
y.create.l HWIO_GERAN_TD_CFG_WORD1_1_ADDR A:0x433d704
y.create.l HWIO_GERAN_TD_CFG_WORD2_1_ADDR A:0x433d708
y.create.l HWIO_GERAN_TD_CFG_WORD3_1_ADDR A:0x433d70c
y.create.l HWIO_HDR_TD_CFG_WORD0_0_ADDR A:0x433d800
y.create.l HWIO_HDR_TD_CFG_WORD1_0_ADDR A:0x433d804
y.create.l HWIO_HDR_TD_CFG_WORD2_0_ADDR A:0x433d808
y.create.l HWIO_HDR_TD_CFG_WORD0_1_ADDR A:0x433d900
y.create.l HWIO_HDR_TD_CFG_WORD1_1_ADDR A:0x433d904
y.create.l HWIO_HDR_TD_CFG_WORD2_1_ADDR A:0x433d908
y.create.l HWIO_TD_STATUS_WORD0_ADDR A:0x433e000
y.create.l HWIO_W_TD_WORD0_0_ADDR A:0x433e100
y.create.l HWIO_W_TD_WORD0_1_ADDR A:0x433e200
y.create.l HWIO_LTE_PDSCH_WORD0_0_ADDR A:0x433e300
y.create.l HWIO_LTE_PDSCH_WORD1_0_ADDR A:0x433e304
y.create.l HWIO_LTE_PDSCH_WORD2_0_ADDR A:0x433e308
y.create.l HWIO_LTE_PDSCH_WORD0_1_ADDR A:0x433e400
y.create.l HWIO_LTE_PDSCH_WORD1_1_ADDR A:0x433e404
y.create.l HWIO_LTE_PDSCH_WORD2_1_ADDR A:0x433e408
y.create.l HWIO_GERAN_TD_WORD0_0_ADDR A:0x433e500
y.create.l HWIO_GERAN_TD_WORD1_0_ADDR A:0x433e504
y.create.l HWIO_GERAN_TD_WORD2_0_ADDR A:0x433e508
y.create.l HWIO_GERAN_TD_WORD3_0_ADDR A:0x433e50c
y.create.l HWIO_GERAN_TD_WORD4_0_ADDR A:0x433e510
y.create.l HWIO_GERAN_TD_WORD5_0_ADDR A:0x433e514
y.create.l HWIO_GERAN_TD_WORD6_0_ADDR A:0x433e518
y.create.l HWIO_GERAN_TD_WORD0_1_ADDR A:0x433e600
y.create.l HWIO_GERAN_TD_WORD1_1_ADDR A:0x433e604
y.create.l HWIO_GERAN_TD_WORD2_1_ADDR A:0x433e608
y.create.l HWIO_GERAN_TD_WORD3_1_ADDR A:0x433e60c
y.create.l HWIO_GERAN_TD_WORD4_1_ADDR A:0x433e610
y.create.l HWIO_GERAN_TD_WORD5_1_ADDR A:0x433e614
y.create.l HWIO_GERAN_TD_WORD6_1_ADDR A:0x433e618
y.create.l HWIO_HDR_TD_WORD0_0_ADDR A:0x433e700
y.create.l HWIO_HDR_TD_WORD1_0_ADDR A:0x433e704
y.create.l HWIO_HDR_TD_WORD2_0_ADDR A:0x433e708
y.create.l HWIO_HDR_TD_WORD3_0_ADDR A:0x433e70c
y.create.l HWIO_HDR_TD_WORD4_0_ADDR A:0x433e710
y.create.l HWIO_HDR_TD_WORD5_0_ADDR A:0x433e714
y.create.l HWIO_HDR_TD_WORD0_1_ADDR A:0x433e800
y.create.l HWIO_HDR_TD_WORD1_1_ADDR A:0x433e804
y.create.l HWIO_HDR_TD_WORD2_1_ADDR A:0x433e808
y.create.l HWIO_HDR_TD_WORD3_1_ADDR A:0x433e80c
y.create.l HWIO_HDR_TD_WORD4_1_ADDR A:0x433e810
y.create.l HWIO_HDR_TD_WORD5_1_ADDR A:0x433e814
y.create.l HWIO_TDECIB_MEM_START_ADDR A:0x433f000
y.create.l HWIO_TDECIB_MEM_END_ADDR A:0x433fffc
y.create.l HWIO_PDMEM_MIN_ADDR A:0x4300000
y.create.l HWIO_PDMEM_MAX_ADDR A:0x430fffc
y.create.l HWIO_CCS_MSTS_ADDR A:0x431fc00
y.create.l HWIO_CCS_MCTL_ADDR A:0x431fc04
y.create.l HWIO_CCS_IPC_ADDR A:0x431fc08
y.create.l HWIO_CCS_PIC0MSK_ADDR A:0x431fc0c
y.create.l HWIO_CCS_PIC0STS_ADDR A:0x431fc10
y.create.l HWIO_CCS_PIC1MSK_ADDR A:0x431fc14
y.create.l HWIO_CCS_PIC1STS_ADDR A:0x431fc18
y.create.l HWIO_CCS_PIC2MSK_ADDR A:0x431fc1c
y.create.l HWIO_CCS_PIC2STS_ADDR A:0x431fc20
y.create.l HWIO_CCS_PIC3MSK_ADDR A:0x431fc24
y.create.l HWIO_CCS_PIC3STS_ADDR A:0x431fc28
y.create.l HWIO_CCS_PIC4MSK_ADDR A:0x431fc2c
y.create.l HWIO_CCS_PIC4STS_ADDR A:0x431fc30
y.create.l HWIO_CCS_PIC5MSK_ADDR A:0x431fc34
y.create.l HWIO_CCS_PIC5STS_ADDR A:0x431fc38
y.create.l HWIO_CCS_PIC6MSK_ADDR A:0x431fc3c
y.create.l HWIO_CCS_PIC6STS_ADDR A:0x431fc40
y.create.l HWIO_CCS_PIT_ADDR A:0x431fc44
y.create.l HWIO_CCS_UTIME_ADDR A:0x431fc48
y.create.l HWIO_CCS_MON0_ADDR A:0x431fc4c
y.create.l HWIO_CCS_MON1_ADDR A:0x431fc50
y.create.l HWIO_CCS_MON2_ADDR A:0x431fc54
y.create.l HWIO_CCS_MON3_ADDR A:0x431fc58
y.create.l HWIO_CCS_MON4_ADDR A:0x431fc5c
y.create.l HWIO_CCS_MON5_ADDR A:0x431fc60
y.create.l HWIO_CCS_MON6_ADDR A:0x431fc64
y.create.l HWIO_CCS_MON7_ADDR A:0x431fc68
y.create.l HWIO_CCS_MON8_ADDR A:0x431fc6c
y.create.l HWIO_CCS_MON9_ADDR A:0x431fc70
y.create.l HWIO_CCS_TMR0_ADDR A:0x431fc7c
y.create.l HWIO_CCS_TMR1_ADDR A:0x431fc80
y.create.l HWIO_CCS_TMR2_ADDR A:0x431fc84
y.create.l HWIO_CCS_TMR3_ADDR A:0x431fc88
y.create.l HWIO_CCS_DMAC_ADDR A:0x431fc8c
y.create.l HWIO_CCS_DMAC0SRC_ADDR A:0x431fc90
y.create.l HWIO_CCS_DMAC1SRC_ADDR A:0x431fca0
y.create.l HWIO_CCS_DMAC2SRC_ADDR A:0x431fcb0
y.create.l HWIO_CCS_DMAC3SRC_ADDR A:0x431fcc0
y.create.l HWIO_CCS_DMAC4SRC_ADDR A:0x431fcd0
y.create.l HWIO_CCS_DMAC5SRC_ADDR A:0x431fce0
y.create.l HWIO_CCS_DMAC6SRC_ADDR A:0x431fcf0
y.create.l HWIO_CCS_DMAC7SRC_ADDR A:0x431fd00
y.create.l HWIO_CCS_DMAC0DST_ADDR A:0x431fc94
y.create.l HWIO_CCS_DMAC1DST_ADDR A:0x431fca4
y.create.l HWIO_CCS_DMAC2DST_ADDR A:0x431fcb4
y.create.l HWIO_CCS_DMAC3DST_ADDR A:0x431fcc4
y.create.l HWIO_CCS_DMAC4DST_ADDR A:0x431fcd4
y.create.l HWIO_CCS_DMAC5DST_ADDR A:0x431fce4
y.create.l HWIO_CCS_DMAC6DST_ADDR A:0x431fcf4
y.create.l HWIO_CCS_DMAC7DST_ADDR A:0x431fd04
y.create.l HWIO_CCS_DMAC0LNK_ADDR A:0x431fc98
y.create.l HWIO_CCS_DMAC1LNK_ADDR A:0x431fca8
y.create.l HWIO_CCS_DMAC2LNK_ADDR A:0x431fcb8
y.create.l HWIO_CCS_DMAC3LNK_ADDR A:0x431fcc8
y.create.l HWIO_CCS_DMAC4LNK_ADDR A:0x431fcd8
y.create.l HWIO_CCS_DMAC5LNK_ADDR A:0x431fce8
y.create.l HWIO_CCS_DMAC6LNK_ADDR A:0x431fcf8
y.create.l HWIO_CCS_DMAC7LNK_ADDR A:0x431fd08
y.create.l HWIO_CCS_DMAC0CTL_ADDR A:0x431fc9c
y.create.l HWIO_CCS_DMAC1CTL_ADDR A:0x431fcac
y.create.l HWIO_CCS_DMAC2CTL_ADDR A:0x431fcbc
y.create.l HWIO_CCS_DMAC3CTL_ADDR A:0x431fccc
y.create.l HWIO_CCS_DMAC4CTL_ADDR A:0x431fcdc
y.create.l HWIO_CCS_DMAC5CTL_ADDR A:0x431fcec
y.create.l HWIO_CCS_DMAC6CTL_ADDR A:0x431fcfc
y.create.l HWIO_CCS_DMAC7CTL_ADDR A:0x431fd0c
y.create.l HWIO_CCS_RFI_ADDR A:0x431fd10
y.create.l HWIO_CCS_SSBI0_ADDR A:0x431fd14
y.create.l HWIO_CCS_SSBI1_ADDR A:0x431fd1c
y.create.l HWIO_CCS_SSBI2_ADDR A:0x431fd24
y.create.l HWIO_CCS_SSBI3_ADDR A:0x431fd2c
y.create.l HWIO_CCS_SSBI0DAT_ADDR A:0x431fd18
y.create.l HWIO_CCS_SSBI1DAT_ADDR A:0x431fd20
y.create.l HWIO_CCS_SSBI2DAT_ADDR A:0x431fd28
y.create.l HWIO_CCS_SSBI3DAT_ADDR A:0x431fd30
y.create.l HWIO_CCS_GRFC_SET_ADDR A:0x431fd44
y.create.l HWIO_CCS_GRFC_CLR_ADDR A:0x431fd48
y.create.l HWIO_CCS_RFFE0_ADDR A:0x431fd4c
y.create.l HWIO_CCS_RFFE1_ADDR A:0x431fd64
y.create.l HWIO_CCS_RFFE2_ADDR A:0x431fd7c
y.create.l HWIO_CCS_RFFE3_ADDR A:0x431fd94
y.create.l HWIO_CCS_RFFE4_ADDR A:0x431fdac
y.create.l HWIO_CCS_RFFE0DAT0_ADDR A:0x431fd50
y.create.l HWIO_CCS_RFFE1DAT0_ADDR A:0x431fd68
y.create.l HWIO_CCS_RFFE2DAT0_ADDR A:0x431fd80
y.create.l HWIO_CCS_RFFE3DAT0_ADDR A:0x431fd98
y.create.l HWIO_CCS_RFFE4DAT0_ADDR A:0x431fdb0
y.create.l HWIO_CCS_RFFE0DAT1_ADDR A:0x431fd54
y.create.l HWIO_CCS_RFFE1DAT1_ADDR A:0x431fd6c
y.create.l HWIO_CCS_RFFE2DAT1_ADDR A:0x431fd84
y.create.l HWIO_CCS_RFFE3DAT1_ADDR A:0x431fd9c
y.create.l HWIO_CCS_RFFE4DAT1_ADDR A:0x431fdb4
y.create.l HWIO_CCS_RFFE0DAT2_ADDR A:0x431fd58
y.create.l HWIO_CCS_RFFE1DAT2_ADDR A:0x431fd70
y.create.l HWIO_CCS_RFFE2DAT2_ADDR A:0x431fd88
y.create.l HWIO_CCS_RFFE3DAT2_ADDR A:0x431fda0
y.create.l HWIO_CCS_RFFE4DAT2_ADDR A:0x431fdb8
y.create.l HWIO_CCS_RFFE0DAT3_ADDR A:0x431fd5c
y.create.l HWIO_CCS_RFFE1DAT3_ADDR A:0x431fd74
y.create.l HWIO_CCS_RFFE2DAT3_ADDR A:0x431fd8c
y.create.l HWIO_CCS_RFFE3DAT3_ADDR A:0x431fda4
y.create.l HWIO_CCS_RFFE4DAT3_ADDR A:0x431fdbc
y.create.l HWIO_CCS_RFFE0_STS_ADDR A:0x431fd60
y.create.l HWIO_CCS_RFFE1_STS_ADDR A:0x431fd78
y.create.l HWIO_CCS_RFFE2_STS_ADDR A:0x431fd90
y.create.l HWIO_CCS_RFFE3_STS_ADDR A:0x431fda8
y.create.l HWIO_CCS_RFFE4_STS_ADDR A:0x431fdc0
y.create.l HWIO_CCS_BP0_ADDR A:0x431fe3c
y.create.l HWIO_CCS_BP1_ADDR A:0x431fe40
y.create.l HWIO_MTC_ENABLE_ADDR A:0x4320000
y.create.l HWIO_MODEM_PWRUP_ADDR A:0x4320004
y.create.l HWIO_MODEM_PWRON_ADDR A:0x4320008
y.create.l HWIO_MODEM_ID_ADDR A:0x432000c
y.create.l HWIO_MODEM_FEATURE_EN_ADDR A:0x4320010
y.create.l HWIO_MODEM_OPTION_EN_ADDR A:0x4320014
y.create.l HWIO_MODEM_CLK_AXI_CFG_ADDR A:0x4320018
y.create.l HWIO_MODEM_CLK_AXI_TRIG_ADDR A:0x432001c
y.create.l HWIO_MODEM_CLK_AXI_STATUS_ADDR A:0x4320020
y.create.l HWIO_MODEM_CLK_TDEC_CFG_ADDR A:0x4320024
y.create.l HWIO_MODEM_CLK_TDEC_TRIG_ADDR A:0x4320028
y.create.l HWIO_MODEM_CLK_TDEC_STATUS_ADDR A:0x432002c
y.create.l HWIO_MODEM_CLK_DBG_CFG_ADDR A:0x4320030
y.create.l HWIO_MODEM_CLK_SPARE_ADDR A:0x4320034
y.create.l HWIO_MODEM_BRIC_MAXI2AXI_TESTBUS_ADDR A:0x4320038
y.create.l HWIO_MODEM_BRIC_MAXI2AXI_TESTBUS_SEL_ADDR A:0x432003c
y.create.l HWIO_MCDMA_RESET_ADDR A:0x4320400
y.create.l HWIO_MCDMA_ENABLE_ADDR A:0x432049c
y.create.l HWIO_MCDMA_LOG_CH_BUSY_ADDR A:0x4320404
y.create.l HWIO_MCDMA_LOG_HW_CH0_SYNC_ADDR A:0x4320408
y.create.l HWIO_MCDMA_LOG_HW_CH1_SYNC_ADDR A:0x432040c
y.create.l HWIO_MCDMA_LOG_HW_CH2_SYNC_ADDR A:0x4320410
y.create.l HWIO_MCDMA_LOG_HW_CH3_SYNC_ADDR A:0x4320414
y.create.l HWIO_MCDMA_LOG_HW_CH4_SYNC_ADDR A:0x4320418
y.create.l HWIO_MCDMA_LOG_HW_CH0_CTL_ADDR A:0x4320420
y.create.l HWIO_MCDMA_LOG_HW_CH1_CTL_ADDR A:0x4320424
y.create.l HWIO_MCDMA_LOG_HW_CH2_CTL_ADDR A:0x4320428
y.create.l HWIO_MCDMA_LOG_HW_CH3_CTL_ADDR A:0x432042c
y.create.l HWIO_MCDMA_LOG_HW_CH4_CTL_ADDR A:0x4320430
y.create.l HWIO_MCDMA_LOG_SW_CH0_RESET_ADDR A:0x4320438
y.create.l HWIO_MCDMA_LOG_SW_CH1_RESET_ADDR A:0x432043c
y.create.l HWIO_MCDMA_LOG_SW_CH2_RESET_ADDR A:0x4320440
y.create.l HWIO_MCDMA_LOG_SW_CH3_RESET_ADDR A:0x4320444
y.create.l HWIO_MCDMA_LOG_SW_CH0_CTL_ADDR A:0x432044c
y.create.l HWIO_MCDMA_LOG_SW_CH1_CTL_ADDR A:0x4320450
y.create.l HWIO_MCDMA_LOG_SW_CH2_CTL_ADDR A:0x4320454
y.create.l HWIO_MCDMA_LOG_SW_CH3_CTL_ADDR A:0x4320458
y.create.l HWIO_MCDMA_PHY_CH_CTL_ADDR A:0x4320460
y.create.l HWIO_MCDMA_LOG_HW_CH0_DBG_ADDR A:0x4320464
y.create.l HWIO_MCDMA_LOG_HW_CH1_DBG_ADDR A:0x4320468
y.create.l HWIO_MCDMA_LOG_HW_CH2_DBG_ADDR A:0x432046c
y.create.l HWIO_MCDMA_LOG_HW_CH3_DBG_ADDR A:0x4320470
y.create.l HWIO_MCDMA_LOG_HW_CH4_DBG_ADDR A:0x4320474
y.create.l HWIO_MCDMA_LOG_SW_CH0_DBG_ADDR A:0x4320478
y.create.l HWIO_MCDMA_LOG_SW_CH1_DBG_ADDR A:0x432047c
y.create.l HWIO_MCDMA_LOG_SW_CH2_DBG_ADDR A:0x4320480
y.create.l HWIO_MCDMA_LOG_SW_CH3_DBG_ADDR A:0x4320484
y.create.l HWIO_MCDMA_PHY_CH_DBG_ADDR A:0x4320488
y.create.l HWIO_MCDMA_VBUF_CFG_DBG_ADDR A:0x432048c
y.create.l HWIO_MCDMA_VBUF_CFG_SEL_ADDR A:0x4320490
y.create.l HWIO_MCDMA_VBUF_CFG_RD0_ADDR A:0x4320494
y.create.l HWIO_MCDMA_VBUF_CFG_RD1_ADDR A:0x4320498
y.create.l HWIO_A2_SW_RESET_THRD_ADDR A:0x4320800
y.create.l HWIO_A2_SW_RESET_ACC_ADDR A:0x4320804
y.create.l HWIO_A2_TASK0_EN_ADDR A:0x4320808
y.create.l HWIO_A2_TASK1_EN_ADDR A:0x432080c
y.create.l HWIO_A2_TASK2_EN_ADDR A:0x4320810
y.create.l HWIO_A2_TASK3_EN_ADDR A:0x4320814
y.create.l HWIO_A2_TASK0_WR_PTR_ADDR A:0x4320820
y.create.l HWIO_A2_TASK1_WR_PTR_ADDR A:0x4320824
y.create.l HWIO_A2_TASK2_WR_PTR_ADDR A:0x4320828
y.create.l HWIO_A2_TASK3_WR_PTR_ADDR A:0x432082c
y.create.l HWIO_A2_TASK0_RD_PTR_ADDR A:0x4320840
y.create.l HWIO_A2_TASK1_RD_PTR_ADDR A:0x4320844
y.create.l HWIO_A2_TASK2_RD_PTR_ADDR A:0x4320848
y.create.l HWIO_A2_TASK3_RD_PTR_ADDR A:0x432084c
y.create.l HWIO_A2_TASK0_RD_PTR_INIT_ADDR A:0x4320860
y.create.l HWIO_A2_TASK1_RD_PTR_INIT_ADDR A:0x4320864
y.create.l HWIO_A2_TASK2_RD_PTR_INIT_ADDR A:0x4320868
y.create.l HWIO_A2_TASK3_RD_PTR_INIT_ADDR A:0x432086c
y.create.l HWIO_A2_TASK0_RD_PTR_INIT_EN_ADDR A:0x4320880
y.create.l HWIO_A2_TASK1_RD_PTR_INIT_EN_ADDR A:0x4320884
y.create.l HWIO_A2_TASK2_RD_PTR_INIT_EN_ADDR A:0x4320888
y.create.l HWIO_A2_TASK3_RD_PTR_INIT_EN_ADDR A:0x432088c
y.create.l HWIO_A2_QUEUE_UPPER_ADDR_ADDR A:0x43208b0
y.create.l HWIO_A2_STATUS0_WR_EN_ADDR A:0x43208c8
y.create.l HWIO_A2_STATUS1_WR_EN_ADDR A:0x43208cc
y.create.l HWIO_A2_STATUS2_WR_EN_ADDR A:0x43208d0
y.create.l HWIO_A2_STATUS3_WR_EN_ADDR A:0x43208d4
y.create.l HWIO_A2_STATUS4_WR_EN_ADDR A:0x43208d8
y.create.l HWIO_A2_STATUS0_WR_START_ADDR A:0x43208dc
y.create.l HWIO_A2_STATUS1_WR_START_ADDR A:0x43208e0
y.create.l HWIO_A2_STATUS2_WR_START_ADDR A:0x43208e4
y.create.l HWIO_A2_STATUS3_WR_START_ADDR A:0x43208e8
y.create.l HWIO_A2_STATUS4_WR_START_ADDR A:0x43208ec
y.create.l HWIO_A2_STATUS0_WR_END_ADDR A:0x43208f0
y.create.l HWIO_A2_STATUS1_WR_END_ADDR A:0x43208f4
y.create.l HWIO_A2_STATUS2_WR_END_ADDR A:0x43208f8
y.create.l HWIO_A2_STATUS3_WR_END_ADDR A:0x43208fc
y.create.l HWIO_A2_STATUS4_WR_END_ADDR A:0x4320900
y.create.l HWIO_A2_STATUS0_WR_PTR_INIT_ADDR A:0x4320904
y.create.l HWIO_A2_STATUS1_WR_PTR_INIT_ADDR A:0x4320908
y.create.l HWIO_A2_STATUS2_WR_PTR_INIT_ADDR A:0x432090c
y.create.l HWIO_A2_STATUS3_WR_PTR_INIT_ADDR A:0x4320910
y.create.l HWIO_A2_STATUS4_WR_PTR_INIT_ADDR A:0x4320914
y.create.l HWIO_A2_STATUS0_WR_PTR_INIT_EN_ADDR A:0x4320918
y.create.l HWIO_A2_STATUS1_WR_PTR_INIT_EN_ADDR A:0x432091c
y.create.l HWIO_A2_STATUS2_WR_PTR_INIT_EN_ADDR A:0x4320920
y.create.l HWIO_A2_STATUS3_WR_PTR_INIT_EN_ADDR A:0x4320924
y.create.l HWIO_A2_STATUS4_WR_PTR_INIT_EN_ADDR A:0x4320928
y.create.l HWIO_A2_STATUS0_WR_PTR_CURRENT_ADDR A:0x432092c
y.create.l HWIO_A2_STATUS1_WR_PTR_CURRENT_ADDR A:0x4320930
y.create.l HWIO_A2_STATUS2_WR_PTR_CURRENT_ADDR A:0x4320934
y.create.l HWIO_A2_STATUS3_WR_PTR_CURRENT_ADDR A:0x4320938
y.create.l HWIO_A2_STATUS4_WR_PTR_CURRENT_ADDR A:0x432093c
y.create.l HWIO_A2_STATUS0_WR_PTR_ADDR A:0x4320940
y.create.l HWIO_A2_STATUS1_WR_PTR_ADDR A:0x4320944
y.create.l HWIO_A2_STATUS2_WR_PTR_ADDR A:0x4320948
y.create.l HWIO_A2_STATUS3_WR_PTR_ADDR A:0x432094c
y.create.l HWIO_A2_STATUS4_WR_PTR_ADDR A:0x4320950
y.create.l HWIO_A2_STATUS0_RD_PTR_ADDR A:0x4320954
y.create.l HWIO_A2_STATUS1_RD_PTR_ADDR A:0x4320958
y.create.l HWIO_A2_STATUS2_RD_PTR_ADDR A:0x432095c
y.create.l HWIO_A2_STATUS3_RD_PTR_ADDR A:0x4320960
y.create.l HWIO_A2_STATUS4_RD_PTR_ADDR A:0x4320964
y.create.l HWIO_A2_FRAG0_THRESHOLD_ADDR A:0x43209c0
y.create.l HWIO_A2_FRAG1_THRESHOLD_ADDR A:0x43209c4
y.create.l HWIO_A2_FRAG0_REFILL_EN_ADDR A:0x43209c8
y.create.l HWIO_A2_FRAG1_REFILL_EN_ADDR A:0x43209cc
y.create.l HWIO_A2_FRAG0_LEN_ADDR A:0x43209d0
y.create.l HWIO_A2_FRAG1_LEN_ADDR A:0x43209d4
y.create.l HWIO_A2_FRAG0_ADDR_ADDR A:0x43209d8
y.create.l HWIO_A2_FRAG1_ADDR_ADDR A:0x43209dc
y.create.l HWIO_A2_FRAG0_PTR_ADDR A:0x43209e0
y.create.l HWIO_A2_FRAG1_PTR_ADDR A:0x43209e4
y.create.l HWIO_A2_FRAG_CACHE_LINE_ADDR A:0x43209e8
y.create.l HWIO_A2_FRAG_CACHE_LINE_MASK_ADDR A:0x43209ec
y.create.l HWIO_A2_FRAG0_TRANSFER_LEN_ADDR A:0x43209f0
y.create.l HWIO_A2_FRAG1_TRANSFER_LEN_ADDR A:0x43209f4
y.create.l HWIO_A2_FRAG0_HDR_LEN_ADDR A:0x43209f8
y.create.l HWIO_A2_FRAG1_HDR_LEN_ADDR A:0x43209fc
y.create.l HWIO_A2_FRAG0_QUEUE_START_ADDR_ADDR A:0x4320a08
y.create.l HWIO_A2_FRAG1_QUEUE_START_ADDR_ADDR A:0x4320a0c
y.create.l HWIO_A2_FRAG0_QUEUE_WR_PTR_ADDR A:0x4320aa0
y.create.l HWIO_A2_FRAG1_QUEUE_WR_PTR_ADDR A:0x4320aa4
y.create.l HWIO_A2_FRAG0_QUEUE_RD_PTR_ADDR A:0x4320aa8
y.create.l HWIO_A2_FRAG1_QUEUE_RD_PTR_ADDR A:0x4320aac
y.create.l HWIO_A2_FRAG0_RD_PTR_INIT_EN_ADDR A:0x4320acc
y.create.l HWIO_A2_FRAG1_RD_PTR_INIT_EN_ADDR A:0x4320ad0
y.create.l HWIO_A2_TIMER0_CFG_ADDR A:0x4320a10
y.create.l HWIO_A2_TIMER1_CFG_ADDR A:0x4320a14
y.create.l HWIO_A2_TIMER2_CFG_ADDR A:0x4320a18
y.create.l HWIO_A2_TIMER3_CFG_ADDR A:0x4320a1c
y.create.l HWIO_A2_TIMER0_CMD_ADDR A:0x4320a20
y.create.l HWIO_A2_TIMER1_CMD_ADDR A:0x4320a24
y.create.l HWIO_A2_TIMER2_CMD_ADDR A:0x4320a28
y.create.l HWIO_A2_TIMER3_CMD_ADDR A:0x4320a2c
y.create.l HWIO_A2_TIMER0_PERIOD_ADDR A:0x4320a40
y.create.l HWIO_A2_TIMER1_PERIOD_ADDR A:0x4320a44
y.create.l HWIO_A2_TIMER2_PERIOD_ADDR A:0x4320a48
y.create.l HWIO_A2_TIMER3_PERIOD_ADDR A:0x4320a4c
y.create.l HWIO_A2_TIMER0_STATUS_ADDR A:0x4320a50
y.create.l HWIO_A2_TIMER1_STATUS_ADDR A:0x4320a54
y.create.l HWIO_A2_TIMER2_STATUS_ADDR A:0x4320a58
y.create.l HWIO_A2_TIMER3_STATUS_ADDR A:0x4320a5c
y.create.l HWIO_A2_PER_DL_CFG_ADDR A:0x4320a70
y.create.l HWIO_A2_PER0_UL_CFG_ADDR A:0x4320a74
y.create.l HWIO_A2_PER1_UL_CFG_ADDR A:0x4320a78
y.create.l HWIO_A2_PER2_UL_CFG_ADDR A:0x4320a7c
y.create.l HWIO_A2_CKSUM_CFG_ADDR A:0x4320adc
y.create.l HWIO_A2_DL_PHY_DEC_TRBLK_THRESHOLD_ADDR A:0x4320a90
y.create.l HWIO_A2_DL_PHY_CFG_ADDR A:0x4320a94
y.create.l HWIO_A2_HW_THRD_EN_ADDR A:0x4320a98
y.create.l HWIO_A2_UL_PHY_CFG_ADDR A:0x4320a9c
y.create.l HWIO_A2_LTE_DLPHY_CMD_ADDR_ADDR A:0x4320ab0
y.create.l HWIO_A2_IP_FILT_FRAG_ADDR_ADDR A:0x4320ab4
y.create.l HWIO_A2_MCDMA_DMA_IN_ADDR_ADDR A:0x4320ab8
y.create.l HWIO_A2_MCDMA_DMA_OUT_ADDR_ADDR A:0x4320abc
y.create.l HWIO_A2_MCDMA_TASK_ADDR_ADDR A:0x4320ac0
y.create.l HWIO_A2_MCDMA_BAM_NDP_ADDR_ADDR A:0x4320ac4
y.create.l HWIO_A2_DECOB_PREFETCH_ADDR_ADDR A:0x4320ac8
y.create.l HWIO_A2_MCDMA_OST_BRST_ADDR A:0x4320ad4
y.create.l HWIO_A2_MCDMA_MAX_BRST_SIZE_ADDR A:0x4320ad8
y.create.l HWIO_A2_HW_CLK_CTL_ADDR A:0x4320ae0
y.create.l HWIO_A2_CLK_EN_CTL_ADDR A:0x4320ae4
y.create.l HWIO_A2_CLK_STATUS_ADDR A:0x4320ae8
y.create.l HWIO_A2_UL_PER_1ST_PKT_INT_EN_ADDR A:0x4320aec
y.create.l HWIO_A2_DBG_LINK_RD_ADDR A:0x4320af0
y.create.l HWIO_A2_DBG_LINK1_RD_ADDR A:0x4320af4
y.create.l HWIO_A2_DBG_FRAG0_LEN_ADDR A:0x4320af8
y.create.l HWIO_A2_DBG_FRAG1_LEN_ADDR A:0x4320afc
y.create.l HWIO_A2_DBG_FRAG2_LEN_ADDR A:0x4320b00
y.create.l HWIO_A2_DBG_FRAG3_LEN_ADDR A:0x4320b04
y.create.l HWIO_A2_DBG_FRAG4_LEN_ADDR A:0x4320b08
y.create.l HWIO_A2_DBG_FRAG0_ADDR_CUR_ADDR A:0x4320b0c
y.create.l HWIO_A2_DBG_FRAG1_ADDR_CUR_ADDR A:0x4320b10
y.create.l HWIO_A2_DBG_FRAG2_ADDR_CUR_ADDR A:0x4320b14
y.create.l HWIO_A2_DBG_FRAG3_ADDR_CUR_ADDR A:0x4320b18
y.create.l HWIO_A2_DBG_FRAG4_ADDR_CUR_ADDR A:0x4320b1c
y.create.l HWIO_A2_DBG_FRAG0_ADDR_NXT_ADDR A:0x4320b20
y.create.l HWIO_A2_DBG_FRAG1_ADDR_NXT_ADDR A:0x4320b24
y.create.l HWIO_A2_DBG_FRAG2_ADDR_NXT_ADDR A:0x4320b28
y.create.l HWIO_A2_DBG_FRAG3_ADDR_NXT_ADDR A:0x4320b2c
y.create.l HWIO_A2_DBG_FRAG4_ADDR_NXT_ADDR A:0x4320b30
y.create.l HWIO_A2_DBG_FRAG0_PTR_ADDR A:0x4320b34
y.create.l HWIO_A2_DBG_FRAG1_PTR_ADDR A:0x4320b38
y.create.l HWIO_A2_DBG_FRAG2_PTR_ADDR A:0x4320b3c
y.create.l HWIO_A2_DBG_FRAG3_PTR_ADDR A:0x4320b40
y.create.l HWIO_A2_DBG_FRAG4_PTR_ADDR A:0x4320b44
y.create.l HWIO_A2_DBG_TRBLK_LENGTH_ADDR A:0x4320b60
y.create.l HWIO_A2_DBG_TRBLK_START_ADDR_ADDR A:0x4320b64
y.create.l HWIO_A2_DBG_TRBLK_SW_INFO0_ADDR A:0x4320b68
y.create.l HWIO_A2_DBG_TRBLK_SW_INFO1_ADDR A:0x4320b6c
y.create.l HWIO_A2_DBG_TRBLK_TRIGGER_ADDR A:0x4320b70
y.create.l HWIO_A2_DBG_TRBLK_STATUS_ADDR A:0x4320b74
y.create.l HWIO_A2_DBG_STRM_ID_ADDR A:0x4320b80
y.create.l HWIO_A2_DBG_DMA_SRC_ADDR A:0x4320b84
y.create.l HWIO_A2_DBG_DMA_DST_ADDR A:0x4320b8c
y.create.l HWIO_A2_DBG_DMA_CTL_ADDR A:0x4320b90
y.create.l HWIO_A2_DBG_TASK_FETCHER_ADDR A:0x4320b94
y.create.l HWIO_A2_DBG_DL0_BAM_ADDR A:0x4320b98
y.create.l HWIO_A2_DBG_DL1_BAM_ADDR A:0x4320b9c
y.create.l HWIO_A2_DBG_DL2_BAM_ADDR A:0x4320ba0
y.create.l HWIO_A2_DBG_UL0_BAM_ADDR A:0x4320ba4
y.create.l HWIO_A2_DBG_UL1_BAM_ADDR A:0x4320ba8
y.create.l HWIO_A2_DBG_UL2_BAM_ADDR A:0x4320bac
y.create.l HWIO_A2_DBG_FRM_ADDR A:0x4320bb0
y.create.l HWIO_A2_DBG_DFRM_ADDR A:0x4320bb4
y.create.l HWIO_A2_DBG_CIPH_ADDR A:0x4320bb8
y.create.l HWIO_A2_DBG_IPF_ADDR A:0x4320bbc
y.create.l HWIO_A2_DBG_MIU0_ADDR A:0x4320bc0
y.create.l HWIO_A2_DBG_MIU1_ADDR A:0x4320bc4
y.create.l HWIO_A2_DBG_MIU2_ADDR A:0x4320bc8
y.create.l HWIO_A2_DBG_MIU3_ADDR A:0x4320bcc
y.create.l HWIO_A2_DBG_TASK_WORD_ADDR A:0x4320bd0
y.create.l HWIO_A2_DBG_UL_CKSUM0_ADDR A:0x4320bd4
y.create.l HWIO_A2_DBG_UL_CKSUM1_ADDR A:0x4320bd8
y.create.l HWIO_A2_DBG_DL_CKSUM0_ADDR A:0x4320bdc
y.create.l HWIO_A2_DBG_DL_CKSUM1_ADDR A:0x4320be0
y.create.l HWIO_A2_DBG_CKSUM_UL_EOT_ADDR A:0x4320be4
y.create.l HWIO_DBG_RESET_ADDR A:0x4320c00
y.create.l HWIO_DBG_ENABLE_ADDR A:0x4320c04
y.create.l HWIO_DBG_LOG_STATUS_ADDR A:0x4320c08
y.create.l HWIO_DBG_MUX_MASK_0_ADDR A:0x4320c0c
y.create.l HWIO_DBG_MUX_MASK_1_ADDR A:0x4320c10
y.create.l HWIO_DBG_MUX_MASK_2_ADDR A:0x4320c14
y.create.l HWIO_DBG_MUX_MASK_3_ADDR A:0x4320c18
y.create.l HWIO_DBG_MUX_MASK_4_ADDR A:0x4320c1c
y.create.l HWIO_DBG_MUX_MASK_5_ADDR A:0x4320c20
y.create.l HWIO_DBG_MUX_MASK_6_ADDR A:0x4320c24
y.create.l HWIO_DBG_MUX_MASK_7_ADDR A:0x4320c28
y.create.l HWIO_DBG_MUX_MASK_8_ADDR A:0x4320c2c
y.create.l HWIO_DBG_MUX_MASK_9_ADDR A:0x4320c30
y.create.l HWIO_DBG_PORT_MUX_ADDR A:0x4320c4c
y.create.l HWIO_DBG_ERR_IRQ_MASK0_ADDR A:0x4320c50
y.create.l HWIO_DBG_ERR_IRQ_MASK1_ADDR A:0x4320c54
y.create.l HWIO_DBG_SW_LOG_ADDR A:0x4320c58
y.create.l HWIO_DBG_DATA_DST_ADDR A:0x4320c5c
y.create.l HWIO_DBG_START_ADDR_ADDR A:0x4320c60
y.create.l HWIO_DBG_EXT_MEM_CNT_VAL_ADDR A:0x4320c64
y.create.l HWIO_DBG_SHRD_START_ADDR_ADDR A:0x4320c68
y.create.l HWIO_DBG_SHRD_END_ADDR_ADDR A:0x4320c6c
y.create.l HWIO_DBG_MAX_OST_BURSTS_ADDR A:0x4320c70
y.create.l HWIO_DBG_ERR_IRQ_EN0_ADDR A:0x4320c74
y.create.l HWIO_DBG_ERR_IRQ_EN1_ADDR A:0x4320c78
y.create.l HWIO_DBG_ERR_IRQ_CLR0_ADDR A:0x4320c7c
y.create.l HWIO_DBG_ERR_IRQ_CLR1_ADDR A:0x4320c80
y.create.l HWIO_DBG_ERR_IRQ_STATUS0_ADDR A:0x4320c84
y.create.l HWIO_DBG_ERR_IRQ_STATUS1_ADDR A:0x4320c88
y.create.l HWIO_MTC_BRDG_MCDMA_RD_ENABLE_ADDR A:0x432100c
y.create.l HWIO_MTC_BRDG_MCDMA_WR_ENABLE_ADDR A:0x4321010
y.create.l HWIO_MTC_BRDG_A2_RD_ENABLE_ADDR A:0x4321014
y.create.l HWIO_MTC_BRDG_CTL_ADDR A:0x4321000
y.create.l HWIO_MTC_BRDG_STATUS_ADDR A:0x4321004
y.create.l HWIO_MTC_BRDG_CLEAR_ADDR A:0x4321008
y.create.l HWIO_A2_SHRD_MEM_BASE_MIN_ADDR A:0x4322000
y.create.l HWIO_A2_SHRD_MEM_BASE_MAX_ADDR A:0x432367c
y.create.l HWIO_MCDMA_TS_STATUS_WORD0_ADDR A:0x4324000
y.create.l HWIO_MCDMA_TS_VBUF_CFG_WORD0_ADDR A:0x4324100
y.create.l HWIO_MCDMA_TS_VBUF_CFG_WORD1_ADDR A:0x4324104
y.create.l HWIO_MCDMA_TS_DMA_CH0_WORD0_ADDR A:0x4324200
y.create.l HWIO_MCDMA_TS_DMA_CH0_WORD1_ADDR A:0x4324204
y.create.l HWIO_MCDMA_TS_DMA_CH0_WORD2_ADDR A:0x4324208
y.create.l HWIO_MCDMA_TS_DMA_CH1_WORD0_ADDR A:0x4324300
y.create.l HWIO_MCDMA_TS_DMA_CH1_WORD1_ADDR A:0x4324304
y.create.l HWIO_MCDMA_TS_DMA_CH1_WORD2_ADDR A:0x4324308
y.create.l HWIO_MCDMA_TS_DMA_CH2_WORD0_ADDR A:0x4324400
y.create.l HWIO_MCDMA_TS_DMA_CH2_WORD1_ADDR A:0x4324404
y.create.l HWIO_MCDMA_TS_DMA_CH2_WORD2_ADDR A:0x4324408
y.create.l HWIO_MCDMA_TS_DMA_CH3_WORD0_ADDR A:0x4324500
y.create.l HWIO_MCDMA_TS_DMA_CH3_WORD1_ADDR A:0x4324504
y.create.l HWIO_MCDMA_TS_DMA_CH3_WORD2_ADDR A:0x4324508
y.create.l HWIO_DBG_STATUS_WORD0_ADDR A:0x4324800
y.create.l HWIO_DBG_TASK_WORD0_ADDR A:0x4324900
y.create.l HWIO_DBG_TASK_WORD1_ADDR A:0x4324904
y.create.l HWIO_UNIV_STMR_MSTMR_EXPY_ADDR A:0x4324c00
y.create.l HWIO_ENCRYPT_ACC_RESET_ADDR A:0x4325000
y.create.l HWIO_ENCRYPT_ACC_CGC_CTL_ADDR A:0x4325004
y.create.l HWIO_ENCRYPT_ACC_CGC_STATUS_ADDR A:0x4325008
y.create.l HWIO_GEA_CONFIG_0_ADDR A:0x432500c
y.create.l HWIO_GEA_INPUT_ADDR A:0x4325010
y.create.l HWIO_GEA_KC_0_ADDR A:0x4325014
y.create.l HWIO_GEA_KC_1_ADDR A:0x4325018
y.create.l HWIO_AMBA_KEY_STRM_WORD0_RD_ADDR A:0x432501c
y.create.l HWIO_AMBA_KEY_STRM_WORD1_RD_ADDR A:0x4325020
y.create.l HWIO_AMBA_KEY_STRM_WORD2_RD_ADDR A:0x4325024
y.create.l HWIO_AMBA_KEY_STRM_WORD3_RD_ADDR A:0x4325028
y.create.l HWIO_AMBA_KEY_STRM_WORD4_RD_ADDR A:0x432502c
y.create.l HWIO_AMBA_KEY_STRM_WORD5_RD_ADDR A:0x4325030
y.create.l HWIO_AMBA_KEY_STRM_WORD6_RD_ADDR A:0x4325034
y.create.l HWIO_AMBA_KEY_STRM_WORD7_RD_ADDR A:0x4325038
y.create.l HWIO_AMBA_KEY_STRM_STATUS_ADDR A:0x432503c
y.create.l HWIO_AFIVE_CONFIG_0_ADDR A:0x4325040
y.create.l HWIO_AFIVE_INPUT_ADDR A:0x4325044
y.create.l HWIO_AFIVE_KC_0_ADDR A:0x4325048
y.create.l HWIO_AFIVE_KC_1_ADDR A:0x432504c
y.create.l HWIO_AFIVE_KEY_STRM_WORD0_RD_ADDR A:0x4325050
y.create.l HWIO_AFIVE_KEY_STRM_WORD1_RD_ADDR A:0x4325054
y.create.l HWIO_AFIVE_KEY_STRM_WORD2_RD_ADDR A:0x4325058
y.create.l HWIO_AFIVE_KEY_STRM_WORD3_RD_ADDR A:0x432505c
y.create.l HWIO_AFIVE_KEY_STRM_WORD4_RD_ADDR A:0x4325060
y.create.l HWIO_AFIVE_KEY_STRM_WORD5_RD_ADDR A:0x4325064
y.create.l HWIO_AFIVE_KEY_STRM_WORD6_RD_ADDR A:0x4325068
y.create.l HWIO_AFIVE_KEY_STRM_WORD7_RD_ADDR A:0x432506c
y.create.l HWIO_AFIVE_KEY_STRM_WORD8_RD_ADDR A:0x4325070
y.create.l HWIO_AFIVE_KEY_STRM_WORD9_RD_ADDR A:0x4325074
y.create.l HWIO_UNIV_STMR_RESET_ADDR A:0x4328800
y.create.l HWIO_UNIV_STMR_ENABLE_ADDR A:0x4328804
y.create.l HWIO_UNIV_STMR_MSTMR_ADDR A:0x4328808
y.create.l HWIO_UNIV_STMR_SYNC_CMD_ADDR A:0x432880c
y.create.l HWIO_UNIV_STMR_MODIFIER_ADJ_ADDR A:0x4328810
y.create.l HWIO_UNIV_STMR_STATUS_ADDR A:0x4328814
y.create.l HWIO_UNIV_STMR_STATUS_DUMP_CMD_ADDR A:0x4328834
y.create.l HWIO_UNIV_STMR_TIME_STATUS_RD_ADDR A:0x4328838
y.create.l HWIO_TX_C0_CTRL_SEL_ADDR A:0x4328880
y.create.l HWIO_TX_C0_TRIG_CMD_ADDR A:0x4328888
y.create.l HWIO_TX_C0_TRIG_VAL_ADDR A:0x4328890
y.create.l HWIO_TX_TRIG_STATUS_ADDR A:0x43288a8
y.create.l HWIO_TX_C0_TRIG_RD_ADDR A:0x43288b0
y.create.l HWIO_UNIV_STMR_TX_SYNC_TIME0_ADDR A:0x43288d0
y.create.l HWIO_UNIV_STMR_TRIG_CTRL_ADDR A:0x43288d8
y.create.l HWIO_UNIV_STMR_TRIG_MASK_ADDR A:0x43288dc
y.create.l HWIO_VFR_SEL_ADDR A:0x43288e0
y.create.l HWIO_UNIV_STMR_SPARE_ADDR A:0x43288e4
y.create.l HWIO_UNIV_STMR_LD_CMD_ADDR A:0x43288ec
y.create.l HWIO_UNIV_STMR_MODIFIER_LD_ADDR A:0x43288f0
y.create.l HWIO_TX_DAC0_UPDATE_STRT_TRIG_CMD_ADDR A:0x4328908
y.create.l HWIO_TX_DAC0_UPDATE_STRT_VAL_ADDR A:0x4328910
y.create.l HWIO_TX_DAC0_UPDATE_STOP_TRIG_CMD_ADDR A:0x4328918
y.create.l HWIO_TX_DAC0_UPDATE_STOP_VAL_ADDR A:0x4328920
y.create.l HWIO_TX_DAC0_IREF_GAIN_ADDR A:0x4328928
y.create.l HWIO_DACCOMP_MUX_CHAIN0_STRT_TRIG_CMD_ADDR A:0x4328930
y.create.l HWIO_DACCOMP_MUX_CHAIN0_STRT_VAL_ADDR A:0x4328938
y.create.l HWIO_DACCOMP_MUX_CHAIN0_STOP_TRIG_CMD_ADDR A:0x4328940
y.create.l HWIO_DACCOMP_MUX_CHAIN0_STOP_VAL_ADDR A:0x4328948
y.create.l HWIO_DACCOMP_MUX_CHAIN0_STRT_TRIG_RD_ADDR A:0x4328950
y.create.l HWIO_DACCOMP_MUX_CHAIN0_STOP_TRIG_RD_ADDR A:0x4328958
y.create.l HWIO_RXFE_C0_TRIG_CMD_ADDR A:0x4328980
y.create.l HWIO_RXFE_C1_TRIG_CMD_ADDR A:0x4328984
y.create.l HWIO_RXFE_C0_TRIG_VAL_ADDR A:0x43289a0
y.create.l HWIO_RXFE_C1_TRIG_VAL_ADDR A:0x43289a4
y.create.l HWIO_RXFE_TRIG_STATUS_ADDR A:0x43289c0
y.create.l HWIO_RXFE_C0_TRIG_RD_ADDR A:0x43289d0
y.create.l HWIO_RXFE_C1_TRIG_RD_ADDR A:0x43289d4
y.create.l HWIO_STMR_TIME_RD_ADDR A:0x4328b00
y.create.l HWIO_STMR_EVT_MATCH_0_ADDR A:0x4328b04
y.create.l HWIO_STMR_EVT_MATCH_1_ADDR A:0x4328b08
y.create.l HWIO_STMR_EVT_MATCH_2_ADDR A:0x4328b0c
y.create.l HWIO_STMR_EVT_MATCH_3_ADDR A:0x4328b10
y.create.l HWIO_STMR_EVT_MATCH_4_ADDR A:0x4328b14
y.create.l HWIO_STMR_EVT_MATCH_5_ADDR A:0x4328b18
y.create.l HWIO_STMR_EVT_MATCH_6_ADDR A:0x4328b1c
y.create.l HWIO_STMR_EVT_MATCH_7_ADDR A:0x4328b20
y.create.l HWIO_STMR_EVT_MATCH_8_ADDR A:0x4328b24
y.create.l HWIO_STMR_EVT_MATCH_9_ADDR A:0x4328b28
y.create.l HWIO_OCIMEM_HW_VERSION_ADDR A:0x50000
y.create.l HWIO_OCIMEM_HW_PROFILE_ADDR A:0x50004
y.create.l HWIO_OCIMEM_GEN_CTL_ADDR A:0x50008
y.create.l HWIO_OCIMEM_GEN_STAT_ADDR A:0x5000c
y.create.l HWIO_OCIMEM_INTC_CLR_ADDR A:0x50010
y.create.l HWIO_OCIMEM_INTC_MASK_ADDR A:0x50014
y.create.l HWIO_OCIMEM_INTC_STAT_ADDR A:0x50018
y.create.l HWIO_OCIMEM_OSW_STATUS_ADDR A:0x5001c
y.create.l HWIO_OCIMEM_PSCGC_TIMERS_ADDR A:0x50034
y.create.l HWIO_OCIMEM_PSCGC_STAT_ADDR A:0x50038
y.create.l HWIO_OCIMEM_PSCGC_M0_M7_CTL_ADDR A:0x5003c
y.create.l HWIO_OCIMEM_ERR_ADDRESS_ADDR A:0x50060
y.create.l HWIO_OCIMEM_AXI_ERR_SYNDROME_ADDR A:0x50064
y.create.l HWIO_OCIMEM_DEBUG_CTL_ADDR A:0x50068
y.create.l HWIO_OCIMEM_MPU_XPU_SCR_ADDR A:0x53000
y.create.l HWIO_OCIMEM_MPU_XPU_SWDR_ADDR A:0x53004
y.create.l HWIO_OCIMEM_MPU_XPU_PRTN_RACR_SSHADOW_ADDR A:0x53008
y.create.l HWIO_OCIMEM_MPU_XPU_PRTN_WACR_SSHADOW_ADDR A:0x5300c
y.create.l HWIO_OCIMEM_MPU_XPU_PRTN_START_SSHADOW0_ADDR A:0x53010
y.create.l HWIO_OCIMEM_MPU_XPU_PRTN_END_SSHADOW0_ADDR A:0x53018
y.create.l HWIO_OCIMEM_MPU_XPU_SEAR0_ADDR A:0x53040
y.create.l HWIO_OCIMEM_MPU_XPU_SESR_ADDR A:0x53048
y.create.l HWIO_OCIMEM_MPU_XPU_SESRRESTORE_ADDR A:0x5304c
y.create.l HWIO_OCIMEM_MPU_XPU_SESYNR0_ADDR A:0x53050
y.create.l HWIO_OCIMEM_MPU_XPU_SESYNR1_ADDR A:0x53054
y.create.l HWIO_OCIMEM_MPU_XPU_SESYNR2_ADDR A:0x53058
y.create.l HWIO_OCIMEM_MPU_XPU_MCR_ADDR A:0x53100
y.create.l HWIO_OCIMEM_MPU_XPU_MEAR0_ADDR A:0x53140
y.create.l HWIO_OCIMEM_MPU_XPU_MESR_ADDR A:0x53148
y.create.l HWIO_OCIMEM_MPU_XPU_MESRRESTORE_ADDR A:0x5314c
y.create.l HWIO_OCIMEM_MPU_XPU_MESYNR0_ADDR A:0x53150
y.create.l HWIO_OCIMEM_MPU_XPU_MESYNR1_ADDR A:0x53154
y.create.l HWIO_OCIMEM_MPU_XPU_MESYNR2_ADDR A:0x53158
y.create.l HWIO_OCIMEM_MPU_XPU_CR_ADDR A:0x53080
y.create.l HWIO_OCIMEM_MPU_XPU_PRTN_RACR_SHADOW_ADDR A:0x53088
y.create.l HWIO_OCIMEM_MPU_XPU_PRTN_WACR_SHADOW_ADDR A:0x5308c
y.create.l HWIO_OCIMEM_MPU_XPU_PRTN_START_SHADOW0_ADDR A:0x53090
y.create.l HWIO_OCIMEM_MPU_XPU_PRTN_END_SHADOW0_ADDR A:0x53098
y.create.l HWIO_OCIMEM_MPU_XPU_RPU_ACR0_ADDR A:0x530a0
y.create.l HWIO_OCIMEM_MPU_XPU_EAR0_ADDR A:0x530c0
y.create.l HWIO_OCIMEM_MPU_XPU_ESR_ADDR A:0x530c8
y.create.l HWIO_OCIMEM_MPU_XPU_ESRRESTORE_ADDR A:0x530cc
y.create.l HWIO_OCIMEM_MPU_XPU_ESYNR0_ADDR A:0x530d0
y.create.l HWIO_OCIMEM_MPU_XPU_ESYNR1_ADDR A:0x530d4
y.create.l HWIO_OCIMEM_MPU_XPU_ESYNR2_ADDR A:0x530d8
y.create.l HWIO_OCIMEM_MPU_XPU_UMR_RACR_ADDR A:0x530e0
y.create.l HWIO_OCIMEM_MPU_XPU_UMR_WACR_ADDR A:0x530e4
y.create.l HWIO_OCIMEM_MPU_XPU_UMR_CNTL_ADDR A:0x530f0
y.create.l HWIO_OCIMEM_MPU_XPU_IDR0_ADDR A:0x53074
y.create.l HWIO_OCIMEM_MPU_XPU_IDR1_ADDR A:0x53078
y.create.l HWIO_OCIMEM_MPU_XPU_REV_ADDR A:0x5307c
y.create.l HWIO_OCIMEM_MPU_XPU_PRT0_RACR0_ADDR A:0x53200
y.create.l HWIO_OCIMEM_MPU_XPU_PRT1_RACR0_ADDR A:0x53280
y.create.l HWIO_OCIMEM_MPU_XPU_PRT2_RACR0_ADDR A:0x53300
y.create.l HWIO_OCIMEM_MPU_XPU_PRT3_RACR0_ADDR A:0x53380
y.create.l HWIO_OCIMEM_MPU_XPU_PRT4_RACR0_ADDR A:0x53400
y.create.l HWIO_OCIMEM_MPU_XPU_PRT5_RACR0_ADDR A:0x53480
y.create.l HWIO_OCIMEM_MPU_XPU_PRT6_RACR0_ADDR A:0x53500
y.create.l HWIO_OCIMEM_MPU_XPU_PRT7_RACR0_ADDR A:0x53580
y.create.l HWIO_OCIMEM_MPU_XPU_PRT0_WACR0_ADDR A:0x53220
y.create.l HWIO_OCIMEM_MPU_XPU_PRT1_WACR0_ADDR A:0x532a0
y.create.l HWIO_OCIMEM_MPU_XPU_PRT2_WACR0_ADDR A:0x53320
y.create.l HWIO_OCIMEM_MPU_XPU_PRT3_WACR0_ADDR A:0x533a0
y.create.l HWIO_OCIMEM_MPU_XPU_PRT4_WACR0_ADDR A:0x53420
y.create.l HWIO_OCIMEM_MPU_XPU_PRT5_WACR0_ADDR A:0x534a0
y.create.l HWIO_OCIMEM_MPU_XPU_PRT6_WACR0_ADDR A:0x53520
y.create.l HWIO_OCIMEM_MPU_XPU_PRT7_WACR0_ADDR A:0x535a0
y.create.l HWIO_OCIMEM_MPU_XPU_PRT0_START0_ADDR A:0x53240
y.create.l HWIO_OCIMEM_MPU_XPU_PRT1_START0_ADDR A:0x532c0
y.create.l HWIO_OCIMEM_MPU_XPU_PRT2_START0_ADDR A:0x53340
y.create.l HWIO_OCIMEM_MPU_XPU_PRT3_START0_ADDR A:0x533c0
y.create.l HWIO_OCIMEM_MPU_XPU_PRT4_START0_ADDR A:0x53440
y.create.l HWIO_OCIMEM_MPU_XPU_PRT5_START0_ADDR A:0x534c0
y.create.l HWIO_OCIMEM_MPU_XPU_PRT6_START0_ADDR A:0x53540
y.create.l HWIO_OCIMEM_MPU_XPU_PRT7_START0_ADDR A:0x535c0
y.create.l HWIO_OCIMEM_MPU_XPU_PRT0_END0_ADDR A:0x53248
y.create.l HWIO_OCIMEM_MPU_XPU_PRT1_END0_ADDR A:0x532c8
y.create.l HWIO_OCIMEM_MPU_XPU_PRT2_END0_ADDR A:0x53348
y.create.l HWIO_OCIMEM_MPU_XPU_PRT3_END0_ADDR A:0x533c8
y.create.l HWIO_OCIMEM_MPU_XPU_PRT4_END0_ADDR A:0x53448
y.create.l HWIO_OCIMEM_MPU_XPU_PRT5_END0_ADDR A:0x534c8
y.create.l HWIO_OCIMEM_MPU_XPU_PRT6_END0_ADDR A:0x53548
y.create.l HWIO_OCIMEM_MPU_XPU_PRT7_END0_ADDR A:0x535c8
y.create.l HWIO_OCIMEM_MPU_XPU_PRT0_SCR_ADDR A:0x53250
y.create.l HWIO_OCIMEM_MPU_XPU_PRT1_SCR_ADDR A:0x532d0
y.create.l HWIO_OCIMEM_MPU_XPU_PRT2_SCR_ADDR A:0x53350
y.create.l HWIO_OCIMEM_MPU_XPU_PRT3_SCR_ADDR A:0x533d0
y.create.l HWIO_OCIMEM_MPU_XPU_PRT4_SCR_ADDR A:0x53450
y.create.l HWIO_OCIMEM_MPU_XPU_PRT5_SCR_ADDR A:0x534d0
y.create.l HWIO_OCIMEM_MPU_XPU_PRT6_SCR_ADDR A:0x53550
y.create.l HWIO_OCIMEM_MPU_XPU_PRT7_SCR_ADDR A:0x535d0
y.create.l HWIO_OCIMEM_MPU_XPU_PRT0_MCR_ADDR A:0x53254
y.create.l HWIO_OCIMEM_MPU_XPU_PRT1_MCR_ADDR A:0x532d4
y.create.l HWIO_OCIMEM_MPU_XPU_PRT2_MCR_ADDR A:0x53354
y.create.l HWIO_OCIMEM_MPU_XPU_PRT3_MCR_ADDR A:0x533d4
y.create.l HWIO_OCIMEM_MPU_XPU_PRT4_MCR_ADDR A:0x53454
y.create.l HWIO_OCIMEM_MPU_XPU_PRT5_MCR_ADDR A:0x534d4
y.create.l HWIO_OCIMEM_MPU_XPU_PRT6_MCR_ADDR A:0x53554
y.create.l HWIO_OCIMEM_MPU_XPU_PRT7_MCR_ADDR A:0x535d4
y.create.l HWIO_OCIMEM_MPU_XPU_PRT0_CNTL0_ADDR A:0x53258
y.create.l HWIO_OCIMEM_MPU_XPU_PRT1_CNTL0_ADDR A:0x532d8
y.create.l HWIO_OCIMEM_MPU_XPU_PRT2_CNTL0_ADDR A:0x53358
y.create.l HWIO_OCIMEM_MPU_XPU_PRT3_CNTL0_ADDR A:0x533d8
y.create.l HWIO_OCIMEM_MPU_XPU_PRT4_CNTL0_ADDR A:0x53458
y.create.l HWIO_OCIMEM_MPU_XPU_PRT5_CNTL0_ADDR A:0x534d8
y.create.l HWIO_OCIMEM_MPU_XPU_PRT6_CNTL0_ADDR A:0x53558
y.create.l HWIO_OCIMEM_MPU_XPU_PRT7_CNTL0_ADDR A:0x535d8
y.create.l HWIO_OCIMEM_MPU_XPU_PRT0_CNTL1_ADDR A:0x5325c
y.create.l HWIO_OCIMEM_MPU_XPU_PRT1_CNTL1_ADDR A:0x532dc
y.create.l HWIO_OCIMEM_MPU_XPU_PRT2_CNTL1_ADDR A:0x5335c
y.create.l HWIO_OCIMEM_MPU_XPU_PRT3_CNTL1_ADDR A:0x533dc
y.create.l HWIO_OCIMEM_MPU_XPU_PRT4_CNTL1_ADDR A:0x5345c
y.create.l HWIO_OCIMEM_MPU_XPU_PRT5_CNTL1_ADDR A:0x534dc
y.create.l HWIO_OCIMEM_MPU_XPU_PRT6_CNTL1_ADDR A:0x5355c
y.create.l HWIO_OCIMEM_MPU_XPU_PRT7_CNTL1_ADDR A:0x535dc
y.create.l HWIO_PCNOC_0_ABT_HW_VERSION_ADDR A:0x23000
y.create.l HWIO_PCNOC_0_ABT_INST_ID_ADDR A:0x23004
y.create.l HWIO_PCNOC_0_ABT_NUM_SLAVES_ADDR A:0x23008
y.create.l HWIO_PCNOC_0_ABT_TIMER_LOADVAL_ADDR A:0x2300c
y.create.l HWIO_PCNOC_0_ABT_TIMER_MODE_ADDR A:0x23010
y.create.l HWIO_PCNOC_0_ABT_INTR_STATUS_ADDR A:0x23014
y.create.l HWIO_PCNOC_0_ABT_INTR_CLEAR_ADDR A:0x23018
y.create.l HWIO_PCNOC_0_ABT_INTR_ENABLE_ADDR A:0x2301c
y.create.l HWIO_PCNOC_0_ABT_SYND_VALID_ADDR A:0x23020
y.create.l HWIO_PCNOC_0_ABT_SYND_CLEAR_ADDR A:0x23024
y.create.l HWIO_PCNOC_0_ABT_SYND_ID_ADDR A:0x23028
y.create.l HWIO_PCNOC_0_ABT_SYND_ADDR0_ADDR A:0x2302c
y.create.l HWIO_PCNOC_0_ABT_SYND_ADDR1_ADDR A:0x23030
y.create.l HWIO_PCNOC_0_ABT_SYND_HREADY_ADDR A:0x23034
y.create.l HWIO_PCNOC_1_ABT_HW_VERSION_ADDR A:0x24000
y.create.l HWIO_PCNOC_1_ABT_INST_ID_ADDR A:0x24004
y.create.l HWIO_PCNOC_1_ABT_NUM_SLAVES_ADDR A:0x24008
y.create.l HWIO_PCNOC_1_ABT_TIMER_LOADVAL_ADDR A:0x2400c
y.create.l HWIO_PCNOC_1_ABT_TIMER_MODE_ADDR A:0x24010
y.create.l HWIO_PCNOC_1_ABT_INTR_STATUS_ADDR A:0x24014
y.create.l HWIO_PCNOC_1_ABT_INTR_CLEAR_ADDR A:0x24018
y.create.l HWIO_PCNOC_1_ABT_INTR_ENABLE_ADDR A:0x2401c
y.create.l HWIO_PCNOC_1_ABT_SYND_VALID_ADDR A:0x24020
y.create.l HWIO_PCNOC_1_ABT_SYND_CLEAR_ADDR A:0x24024
y.create.l HWIO_PCNOC_1_ABT_SYND_ID_ADDR A:0x24028
y.create.l HWIO_PCNOC_1_ABT_SYND_ADDR0_ADDR A:0x2402c
y.create.l HWIO_PCNOC_1_ABT_SYND_ADDR1_ADDR A:0x24030
y.create.l HWIO_PCNOC_1_ABT_SYND_HREADY_ADDR A:0x24034
y.create.l HWIO_PCNOC_2_ABT_HW_VERSION_ADDR A:0x25000
y.create.l HWIO_PCNOC_2_ABT_INST_ID_ADDR A:0x25004
y.create.l HWIO_PCNOC_2_ABT_NUM_SLAVES_ADDR A:0x25008
y.create.l HWIO_PCNOC_2_ABT_TIMER_LOADVAL_ADDR A:0x2500c
y.create.l HWIO_PCNOC_2_ABT_TIMER_MODE_ADDR A:0x25010
y.create.l HWIO_PCNOC_2_ABT_INTR_STATUS_ADDR A:0x25014
y.create.l HWIO_PCNOC_2_ABT_INTR_CLEAR_ADDR A:0x25018
y.create.l HWIO_PCNOC_2_ABT_INTR_ENABLE_ADDR A:0x2501c
y.create.l HWIO_PCNOC_2_ABT_SYND_VALID_ADDR A:0x25020
y.create.l HWIO_PCNOC_2_ABT_SYND_CLEAR_ADDR A:0x25024
y.create.l HWIO_PCNOC_2_ABT_SYND_ID_ADDR A:0x25028
y.create.l HWIO_PCNOC_2_ABT_SYND_ADDR0_ADDR A:0x2502c
y.create.l HWIO_PCNOC_2_ABT_SYND_ADDR1_ADDR A:0x25030
y.create.l HWIO_PCNOC_2_ABT_SYND_HREADY_ADDR A:0x25034
y.create.l HWIO_PCNOC_3_ABT_HW_VERSION_ADDR A:0x26000
y.create.l HWIO_PCNOC_3_ABT_INST_ID_ADDR A:0x26004
y.create.l HWIO_PCNOC_3_ABT_NUM_SLAVES_ADDR A:0x26008
y.create.l HWIO_PCNOC_3_ABT_TIMER_LOADVAL_ADDR A:0x2600c
y.create.l HWIO_PCNOC_3_ABT_TIMER_MODE_ADDR A:0x26010
y.create.l HWIO_PCNOC_3_ABT_INTR_STATUS_ADDR A:0x26014
y.create.l HWIO_PCNOC_3_ABT_INTR_CLEAR_ADDR A:0x26018
y.create.l HWIO_PCNOC_3_ABT_INTR_ENABLE_ADDR A:0x2601c
y.create.l HWIO_PCNOC_3_ABT_SYND_VALID_ADDR A:0x26020
y.create.l HWIO_PCNOC_3_ABT_SYND_CLEAR_ADDR A:0x26024
y.create.l HWIO_PCNOC_3_ABT_SYND_ID_ADDR A:0x26028
y.create.l HWIO_PCNOC_3_ABT_SYND_ADDR0_ADDR A:0x2602c
y.create.l HWIO_PCNOC_3_ABT_SYND_ADDR1_ADDR A:0x26030
y.create.l HWIO_PCNOC_3_ABT_SYND_HREADY_ADDR A:0x26034
y.create.l HWIO_PCNOC_4_ABT_HW_VERSION_ADDR A:0x8801000
y.create.l HWIO_PCNOC_4_ABT_INST_ID_ADDR A:0x8801004
y.create.l HWIO_PCNOC_4_ABT_NUM_SLAVES_ADDR A:0x8801008
y.create.l HWIO_PCNOC_4_ABT_TIMER_LOADVAL_ADDR A:0x880100c
y.create.l HWIO_PCNOC_4_ABT_TIMER_MODE_ADDR A:0x8801010
y.create.l HWIO_PCNOC_4_ABT_INTR_STATUS_ADDR A:0x8801014
y.create.l HWIO_PCNOC_4_ABT_INTR_CLEAR_ADDR A:0x8801018
y.create.l HWIO_PCNOC_4_ABT_INTR_ENABLE_ADDR A:0x880101c
y.create.l HWIO_PCNOC_4_ABT_SYND_VALID_ADDR A:0x8801020
y.create.l HWIO_PCNOC_4_ABT_SYND_CLEAR_ADDR A:0x8801024
y.create.l HWIO_PCNOC_4_ABT_SYND_ID_ADDR A:0x8801028
y.create.l HWIO_PCNOC_4_ABT_SYND_ADDR0_ADDR A:0x880102c
y.create.l HWIO_PCNOC_4_ABT_SYND_ADDR1_ADDR A:0x8801030
y.create.l HWIO_PCNOC_4_ABT_SYND_HREADY_ADDR A:0x8801034
y.create.l HWIO_PCNOC_5_ABT_HW_VERSION_ADDR A:0x28000
y.create.l HWIO_PCNOC_5_ABT_INST_ID_ADDR A:0x28004
y.create.l HWIO_PCNOC_5_ABT_NUM_SLAVES_ADDR A:0x28008
y.create.l HWIO_PCNOC_5_ABT_TIMER_LOADVAL_ADDR A:0x2800c
y.create.l HWIO_PCNOC_5_ABT_TIMER_MODE_ADDR A:0x28010
y.create.l HWIO_PCNOC_5_ABT_INTR_STATUS_ADDR A:0x28014
y.create.l HWIO_PCNOC_5_ABT_INTR_CLEAR_ADDR A:0x28018
y.create.l HWIO_PCNOC_5_ABT_INTR_ENABLE_ADDR A:0x2801c
y.create.l HWIO_PCNOC_5_ABT_SYND_VALID_ADDR A:0x28020
y.create.l HWIO_PCNOC_5_ABT_SYND_CLEAR_ADDR A:0x28024
y.create.l HWIO_PCNOC_5_ABT_SYND_ID_ADDR A:0x28028
y.create.l HWIO_PCNOC_5_ABT_SYND_ADDR0_ADDR A:0x2802c
y.create.l HWIO_PCNOC_5_ABT_SYND_ADDR1_ADDR A:0x28030
y.create.l HWIO_PCNOC_5_ABT_SYND_HREADY_ADDR A:0x28034
y.create.l HWIO_PCNOC_6_ABT_HW_VERSION_ADDR A:0x29000
y.create.l HWIO_PCNOC_6_ABT_INST_ID_ADDR A:0x29004
y.create.l HWIO_PCNOC_6_ABT_NUM_SLAVES_ADDR A:0x29008
y.create.l HWIO_PCNOC_6_ABT_TIMER_LOADVAL_ADDR A:0x2900c
y.create.l HWIO_PCNOC_6_ABT_TIMER_MODE_ADDR A:0x29010
y.create.l HWIO_PCNOC_6_ABT_INTR_STATUS_ADDR A:0x29014
y.create.l HWIO_PCNOC_6_ABT_INTR_CLEAR_ADDR A:0x29018
y.create.l HWIO_PCNOC_6_ABT_INTR_ENABLE_ADDR A:0x2901c
y.create.l HWIO_PCNOC_6_ABT_SYND_VALID_ADDR A:0x29020
y.create.l HWIO_PCNOC_6_ABT_SYND_CLEAR_ADDR A:0x29024
y.create.l HWIO_PCNOC_6_ABT_SYND_ID_ADDR A:0x29028
y.create.l HWIO_PCNOC_6_ABT_SYND_ADDR0_ADDR A:0x2902c
y.create.l HWIO_PCNOC_6_ABT_SYND_ADDR1_ADDR A:0x29030
y.create.l HWIO_PCNOC_6_ABT_SYND_HREADY_ADDR A:0x29034
y.create.l HWIO_PCNOC_7_ABT_HW_VERSION_ADDR A:0x2a000
y.create.l HWIO_PCNOC_7_ABT_INST_ID_ADDR A:0x2a004
y.create.l HWIO_PCNOC_7_ABT_NUM_SLAVES_ADDR A:0x2a008
y.create.l HWIO_PCNOC_7_ABT_TIMER_LOADVAL_ADDR A:0x2a00c
y.create.l HWIO_PCNOC_7_ABT_TIMER_MODE_ADDR A:0x2a010
y.create.l HWIO_PCNOC_7_ABT_INTR_STATUS_ADDR A:0x2a014
y.create.l HWIO_PCNOC_7_ABT_INTR_CLEAR_ADDR A:0x2a018
y.create.l HWIO_PCNOC_7_ABT_INTR_ENABLE_ADDR A:0x2a01c
y.create.l HWIO_PCNOC_7_ABT_SYND_VALID_ADDR A:0x2a020
y.create.l HWIO_PCNOC_7_ABT_SYND_CLEAR_ADDR A:0x2a024
y.create.l HWIO_PCNOC_7_ABT_SYND_ID_ADDR A:0x2a028
y.create.l HWIO_PCNOC_7_ABT_SYND_ADDR0_ADDR A:0x2a02c
y.create.l HWIO_PCNOC_7_ABT_SYND_ADDR1_ADDR A:0x2a030
y.create.l HWIO_PCNOC_7_ABT_SYND_HREADY_ADDR A:0x2a034
y.create.l HWIO_PCNOC_OBS_ID_COREID_ADDR A:0x500000
y.create.l HWIO_PCNOC_OBS_ID_REVISIONID_ADDR A:0x500004
y.create.l HWIO_PCNOC_OBS_FAULTEN_ADDR A:0x500008
y.create.l HWIO_PCNOC_OBS_ERRVLD_ADDR A:0x50000c
y.create.l HWIO_PCNOC_OBS_ERRCLR_ADDR A:0x500010
y.create.l HWIO_PCNOC_OBS_ERRLOG0_ADDR A:0x500014
y.create.l HWIO_PCNOC_OBS_ERRLOG1_ADDR A:0x500018
y.create.l HWIO_PCNOC_OBS_ERRLOG2_ADDR A:0x50001c
y.create.l HWIO_PCNOC_OBS_ERRLOG3_ADDR A:0x500020
y.create.l HWIO_PCNOC_OBS_ERRLOG4_ADDR A:0x500024
y.create.l HWIO_PCNOC_OBS_ERRLOG5_ADDR A:0x500028
y.create.l HWIO_PCNOC_OBS_STALLEN_ADDR A:0x500038
y.create.l HWIO_PCNOC_OBS_DBG_ID_COREID_ADDR A:0x500080
y.create.l HWIO_PCNOC_OBS_DBG_ID_REVISIONID_ADDR A:0x500084
y.create.l HWIO_PCNOC_OBS_DBG_ATBID_ADDR A:0x500088
y.create.l HWIO_PCNOC_OBS_DBG_ATBEN_ADDR A:0x50008c
y.create.l HWIO_PCNOC_OBS_DBG_SYNCPERIOD_ADDR A:0x500090
y.create.l HWIO_PCNOC_QXM_CRYPTO0_TFILT_ID_COREID_ADDR A:0x501000
y.create.l HWIO_PCNOC_QXM_CRYPTO0_TFILT_ID_REVISIONID_ADDR A:0x501004
y.create.l HWIO_PCNOC_QXM_CRYPTO0_TFILT_MODE_ADDR A:0x501008
y.create.l HWIO_PCNOC_QXM_CRYPTO0_TFILT_ADDRBASE_LOW_ADDR A:0x50100c
y.create.l HWIO_PCNOC_QXM_CRYPTO0_TFILT_ADDRBASE_HIGH_ADDR A:0x501010
y.create.l HWIO_PCNOC_QXM_CRYPTO0_TFILT_ADDRWINDOWSIZE_ADDR A:0x501014
y.create.l HWIO_PCNOC_QXM_CRYPTO0_TFILT_SRCIDBASE_ADDR A:0x501018
y.create.l HWIO_PCNOC_QXM_CRYPTO0_TFILT_SRCIDMASK_ADDR A:0x50101c
y.create.l HWIO_PCNOC_QXM_CRYPTO0_TFILT_OPCODE_ADDR A:0x501020
y.create.l HWIO_PCNOC_QXM_CRYPTO0_TFILT_USERBASE_ADDR A:0x501024
y.create.l HWIO_PCNOC_QXM_CRYPTO0_TFILT_USERMASK_ADDR A:0x501028
y.create.l HWIO_PCNOC_QXM_SDC1_TFILT_ID_COREID_ADDR A:0x501080
y.create.l HWIO_PCNOC_QXM_SDC1_TFILT_ID_REVISIONID_ADDR A:0x501084
y.create.l HWIO_PCNOC_QXM_SDC1_TFILT_MODE_ADDR A:0x501088
y.create.l HWIO_PCNOC_QXM_SDC1_TFILT_ADDRBASE_LOW_ADDR A:0x50108c
y.create.l HWIO_PCNOC_QXM_SDC1_TFILT_ADDRBASE_HIGH_ADDR A:0x501090
y.create.l HWIO_PCNOC_QXM_SDC1_TFILT_ADDRWINDOWSIZE_ADDR A:0x501094
y.create.l HWIO_PCNOC_QXM_SDC1_TFILT_SRCIDBASE_ADDR A:0x501098
y.create.l HWIO_PCNOC_QXM_SDC1_TFILT_SRCIDMASK_ADDR A:0x50109c
y.create.l HWIO_PCNOC_QXM_SDC1_TFILT_OPCODE_ADDR A:0x5010a0
y.create.l HWIO_PCNOC_QXM_SDC1_TFILT_USERBASE_ADDR A:0x5010a4
y.create.l HWIO_PCNOC_QXM_SDC1_TFILT_USERMASK_ADDR A:0x5010a8
y.create.l HWIO_PCNOC_QXM_SDC2_TFILT_ID_COREID_ADDR A:0x501100
y.create.l HWIO_PCNOC_QXM_SDC2_TFILT_ID_REVISIONID_ADDR A:0x501104
y.create.l HWIO_PCNOC_QXM_SDC2_TFILT_MODE_ADDR A:0x501108
y.create.l HWIO_PCNOC_QXM_SDC2_TFILT_ADDRBASE_LOW_ADDR A:0x50110c
y.create.l HWIO_PCNOC_QXM_SDC2_TFILT_ADDRBASE_HIGH_ADDR A:0x501110
y.create.l HWIO_PCNOC_QXM_SDC2_TFILT_ADDRWINDOWSIZE_ADDR A:0x501114
y.create.l HWIO_PCNOC_QXM_SDC2_TFILT_SRCIDBASE_ADDR A:0x501118
y.create.l HWIO_PCNOC_QXM_SDC2_TFILT_SRCIDMASK_ADDR A:0x50111c
y.create.l HWIO_PCNOC_QXM_SDC2_TFILT_OPCODE_ADDR A:0x501120
y.create.l HWIO_PCNOC_QXM_SDC2_TFILT_USERBASE_ADDR A:0x501124
y.create.l HWIO_PCNOC_QXM_SDC2_TFILT_USERMASK_ADDR A:0x501128
y.create.l HWIO_PCNOC_QHM2_TFILT_ID_COREID_ADDR A:0x501180
y.create.l HWIO_PCNOC_QHM2_TFILT_ID_REVISIONID_ADDR A:0x501184
y.create.l HWIO_PCNOC_QHM2_TFILT_MODE_ADDR A:0x501188
y.create.l HWIO_PCNOC_QHM2_TFILT_ADDRBASE_LOW_ADDR A:0x50118c
y.create.l HWIO_PCNOC_QHM2_TFILT_ADDRWINDOWSIZE_ADDR A:0x501194
y.create.l HWIO_PCNOC_QHM2_TFILT_SRCIDBASE_ADDR A:0x501198
y.create.l HWIO_PCNOC_QHM2_TFILT_SRCIDMASK_ADDR A:0x50119c
y.create.l HWIO_PCNOC_QHM2_TFILT_OPCODE_ADDR A:0x5011a0
y.create.l HWIO_PCNOC_QHM2_TFILT_USERBASE_ADDR A:0x5011a4
y.create.l HWIO_PCNOC_QHM2_TFILT_USERMASK_ADDR A:0x5011a8
y.create.l HWIO_PCNOC_QHM1_TFILT_ID_COREID_ADDR A:0x501200
y.create.l HWIO_PCNOC_QHM1_TFILT_ID_REVISIONID_ADDR A:0x501204
y.create.l HWIO_PCNOC_QHM1_TFILT_MODE_ADDR A:0x501208
y.create.l HWIO_PCNOC_QHM1_TFILT_ADDRBASE_LOW_ADDR A:0x50120c
y.create.l HWIO_PCNOC_QHM1_TFILT_ADDRWINDOWSIZE_ADDR A:0x501214
y.create.l HWIO_PCNOC_QHM1_TFILT_SRCIDBASE_ADDR A:0x501218
y.create.l HWIO_PCNOC_QHM1_TFILT_SRCIDMASK_ADDR A:0x50121c
y.create.l HWIO_PCNOC_QHM1_TFILT_OPCODE_ADDR A:0x501220
y.create.l HWIO_PCNOC_QHM1_TFILT_USERBASE_ADDR A:0x501224
y.create.l HWIO_PCNOC_QHM1_TFILT_USERMASK_ADDR A:0x501228
y.create.l HWIO_PCNOC_QXM_BIMC_TFILT_ID_COREID_ADDR A:0x501280
y.create.l HWIO_PCNOC_QXM_BIMC_TFILT_ID_REVISIONID_ADDR A:0x501284
y.create.l HWIO_PCNOC_QXM_BIMC_TFILT_MODE_ADDR A:0x501288
y.create.l HWIO_PCNOC_QXM_BIMC_TFILT_ADDRBASE_LOW_ADDR A:0x50128c
y.create.l HWIO_PCNOC_QXM_BIMC_TFILT_ADDRBASE_HIGH_ADDR A:0x501290
y.create.l HWIO_PCNOC_QXM_BIMC_TFILT_ADDRWINDOWSIZE_ADDR A:0x501294
y.create.l HWIO_PCNOC_QXM_BIMC_TFILT_SRCIDBASE_ADDR A:0x501298
y.create.l HWIO_PCNOC_QXM_BIMC_TFILT_SRCIDMASK_ADDR A:0x50129c
y.create.l HWIO_PCNOC_QXM_BIMC_TFILT_OPCODE_ADDR A:0x5012a0
y.create.l HWIO_PCNOC_QXM_BIMC_TFILT_USERBASE_ADDR A:0x5012a4
y.create.l HWIO_PCNOC_QXM_BIMC_TFILT_USERMASK_ADDR A:0x5012a8
y.create.l HWIO_PCNOC_QDSS_BAM_TFILT_ID_COREID_ADDR A:0x501300
y.create.l HWIO_PCNOC_QDSS_BAM_TFILT_ID_REVISIONID_ADDR A:0x501304
y.create.l HWIO_PCNOC_QDSS_BAM_TFILT_MODE_ADDR A:0x501308
y.create.l HWIO_PCNOC_QDSS_BAM_TFILT_ADDRBASE_LOW_ADDR A:0x50130c
y.create.l HWIO_PCNOC_QDSS_BAM_TFILT_ADDRWINDOWSIZE_ADDR A:0x501314
y.create.l HWIO_PCNOC_QDSS_BAM_TFILT_SRCIDBASE_ADDR A:0x501318
y.create.l HWIO_PCNOC_QDSS_BAM_TFILT_SRCIDMASK_ADDR A:0x50131c
y.create.l HWIO_PCNOC_QDSS_BAM_TFILT_OPCODE_ADDR A:0x501320
y.create.l HWIO_PCNOC_QDSS_BAM_TFILT_USERBASE_ADDR A:0x501324
y.create.l HWIO_PCNOC_QDSS_BAM_TFILT_USERMASK_ADDR A:0x501328
y.create.l HWIO_PCNOC_HSIC_TFILT_ID_COREID_ADDR A:0x501380
y.create.l HWIO_PCNOC_HSIC_TFILT_ID_REVISIONID_ADDR A:0x501384
y.create.l HWIO_PCNOC_HSIC_TFILT_MODE_ADDR A:0x501388
y.create.l HWIO_PCNOC_HSIC_TFILT_ADDRBASE_LOW_ADDR A:0x50138c
y.create.l HWIO_PCNOC_HSIC_TFILT_ADDRWINDOWSIZE_ADDR A:0x501394
y.create.l HWIO_PCNOC_HSIC_TFILT_SRCIDBASE_ADDR A:0x501398
y.create.l HWIO_PCNOC_HSIC_TFILT_SRCIDMASK_ADDR A:0x50139c
y.create.l HWIO_PCNOC_HSIC_TFILT_OPCODE_ADDR A:0x5013a0
y.create.l HWIO_PCNOC_HSIC_TFILT_USERBASE_ADDR A:0x5013a4
y.create.l HWIO_PCNOC_HSIC_TFILT_USERMASK_ADDR A:0x5013a8
y.create.l HWIO_PCNOC_SGMI_TFILT_ID_COREID_ADDR A:0x501400
y.create.l HWIO_PCNOC_SGMI_TFILT_ID_REVISIONID_ADDR A:0x501404
y.create.l HWIO_PCNOC_SGMI_TFILT_MODE_ADDR A:0x501408
y.create.l HWIO_PCNOC_SGMI_TFILT_ADDRBASE_LOW_ADDR A:0x50140c
y.create.l HWIO_PCNOC_SGMI_TFILT_ADDRWINDOWSIZE_ADDR A:0x501414
y.create.l HWIO_PCNOC_SGMI_TFILT_SRCIDBASE_ADDR A:0x501418
y.create.l HWIO_PCNOC_SGMI_TFILT_SRCIDMASK_ADDR A:0x50141c
y.create.l HWIO_PCNOC_SGMI_TFILT_OPCODE_ADDR A:0x501420
y.create.l HWIO_PCNOC_SGMI_TFILT_USERBASE_ADDR A:0x501424
y.create.l HWIO_PCNOC_SGMI_TFILT_USERMASK_ADDR A:0x501428
y.create.l HWIO_PCNOC_USB_HS1_TFILT_ID_COREID_ADDR A:0x501480
y.create.l HWIO_PCNOC_USB_HS1_TFILT_ID_REVISIONID_ADDR A:0x501484
y.create.l HWIO_PCNOC_USB_HS1_TFILT_MODE_ADDR A:0x501488
y.create.l HWIO_PCNOC_USB_HS1_TFILT_ADDRBASE_LOW_ADDR A:0x50148c
y.create.l HWIO_PCNOC_USB_HS1_TFILT_ADDRWINDOWSIZE_ADDR A:0x501494
y.create.l HWIO_PCNOC_USB_HS1_TFILT_SRCIDBASE_ADDR A:0x501498
y.create.l HWIO_PCNOC_USB_HS1_TFILT_SRCIDMASK_ADDR A:0x50149c
y.create.l HWIO_PCNOC_USB_HS1_TFILT_OPCODE_ADDR A:0x5014a0
y.create.l HWIO_PCNOC_USB_HS1_TFILT_USERBASE_ADDR A:0x5014a4
y.create.l HWIO_PCNOC_USB_HS1_TFILT_USERMASK_ADDR A:0x5014a8
y.create.l HWIO_PCNOC_QXM_NOC_TFILT_ID_COREID_ADDR A:0x501500
y.create.l HWIO_PCNOC_QXM_NOC_TFILT_ID_REVISIONID_ADDR A:0x501504
y.create.l HWIO_PCNOC_QXM_NOC_TFILT_MODE_ADDR A:0x501508
y.create.l HWIO_PCNOC_QXM_NOC_TFILT_ADDRBASE_LOW_ADDR A:0x50150c
y.create.l HWIO_PCNOC_QXM_NOC_TFILT_ADDRBASE_HIGH_ADDR A:0x501510
y.create.l HWIO_PCNOC_QXM_NOC_TFILT_ADDRWINDOWSIZE_ADDR A:0x501514
y.create.l HWIO_PCNOC_QXM_NOC_TFILT_SRCIDBASE_ADDR A:0x501518
y.create.l HWIO_PCNOC_QXM_NOC_TFILT_SRCIDMASK_ADDR A:0x50151c
y.create.l HWIO_PCNOC_QXM_NOC_TFILT_OPCODE_ADDR A:0x501520
y.create.l HWIO_PCNOC_QXM_NOC_TFILT_USERBASE_ADDR A:0x501524
y.create.l HWIO_PCNOC_QXM_NOC_TFILT_USERMASK_ADDR A:0x501528
y.create.l HWIO_PCNOC_QDSS_ETR_TFILT_ID_COREID_ADDR A:0x501580
y.create.l HWIO_PCNOC_QDSS_ETR_TFILT_ID_REVISIONID_ADDR A:0x501584
y.create.l HWIO_PCNOC_QDSS_ETR_TFILT_MODE_ADDR A:0x501588
y.create.l HWIO_PCNOC_QDSS_ETR_TFILT_ADDRBASE_LOW_ADDR A:0x50158c
y.create.l HWIO_PCNOC_QDSS_ETR_TFILT_ADDRWINDOWSIZE_ADDR A:0x501594
y.create.l HWIO_PCNOC_QDSS_ETR_TFILT_SRCIDBASE_ADDR A:0x501598
y.create.l HWIO_PCNOC_QDSS_ETR_TFILT_SRCIDMASK_ADDR A:0x50159c
y.create.l HWIO_PCNOC_QDSS_ETR_TFILT_OPCODE_ADDR A:0x5015a0
y.create.l HWIO_PCNOC_QDSS_ETR_TFILT_USERBASE_ADDR A:0x5015a4
y.create.l HWIO_PCNOC_QDSS_ETR_TFILT_USERMASK_ADDR A:0x5015a8
y.create.l HWIO_PCNOC_TPRB0_TPROF_ID_COREID_ADDR A:0x502000
y.create.l HWIO_PCNOC_TPRB0_TPROF_ID_REVISIONID_ADDR A:0x502004
y.create.l HWIO_PCNOC_TPRB0_TPROF_EN_ADDR A:0x502008
y.create.l HWIO_PCNOC_TPRB0_TPROF_MODE_ADDR A:0x50200c
y.create.l HWIO_PCNOC_TPRB0_TPROF_OBSERVEDSEL_0_ADDR A:0x502010
y.create.l HWIO_PCNOC_TPRB0_TPROF_OBSERVEDSEL_1_ADDR A:0x502014
y.create.l HWIO_PCNOC_TPRB0_TPROF_NTENURELINES_0_ADDR A:0x502020
y.create.l HWIO_PCNOC_TPRB0_TPROF_THRESHOLDS_0_0_ADDR A:0x50202c
y.create.l HWIO_PCNOC_TPRB0_TPROF_THRESHOLDS_0_1_ADDR A:0x502030
y.create.l HWIO_PCNOC_TPRB0_TPROF_THRESHOLDS_0_2_ADDR A:0x502034
y.create.l HWIO_PCNOC_TPRB0_TPROF_THRESHOLDS_1_0_ADDR A:0x50203c
y.create.l HWIO_PCNOC_TPRB0_TPROF_THRESHOLDS_1_1_ADDR A:0x502040
y.create.l HWIO_PCNOC_TPRB0_TPROF_THRESHOLDS_1_2_ADDR A:0x502044
y.create.l HWIO_PCNOC_TPRB0_TPROF_OVERFLOWSTATUS_ADDR A:0x50206c
y.create.l HWIO_PCNOC_TPRB0_TPROF_OVERFLOWRESET_ADDR A:0x502070
y.create.l HWIO_PCNOC_TPRB0_TPROF_PENDINGEVENTMODE_ADDR A:0x502074
y.create.l HWIO_PCNOC_TPRB0_TPROF_PRESCALER_ADDR A:0x502078
y.create.l HWIO_PCNOC_TPRB1_TPROF_ID_COREID_ADDR A:0x502080
y.create.l HWIO_PCNOC_TPRB1_TPROF_ID_REVISIONID_ADDR A:0x502084
y.create.l HWIO_PCNOC_TPRB1_TPROF_EN_ADDR A:0x502088
y.create.l HWIO_PCNOC_TPRB1_TPROF_MODE_ADDR A:0x50208c
y.create.l HWIO_PCNOC_TPRB1_TPROF_OBSERVEDSEL_0_ADDR A:0x502090
y.create.l HWIO_PCNOC_TPRB1_TPROF_OBSERVEDSEL_1_ADDR A:0x502094
y.create.l HWIO_PCNOC_TPRB1_TPROF_NTENURELINES_0_ADDR A:0x5020a0
y.create.l HWIO_PCNOC_TPRB1_TPROF_THRESHOLDS_0_0_ADDR A:0x5020ac
y.create.l HWIO_PCNOC_TPRB1_TPROF_THRESHOLDS_0_1_ADDR A:0x5020b0
y.create.l HWIO_PCNOC_TPRB1_TPROF_THRESHOLDS_0_2_ADDR A:0x5020b4
y.create.l HWIO_PCNOC_TPRB1_TPROF_THRESHOLDS_1_0_ADDR A:0x5020bc
y.create.l HWIO_PCNOC_TPRB1_TPROF_THRESHOLDS_1_1_ADDR A:0x5020c0
y.create.l HWIO_PCNOC_TPRB1_TPROF_THRESHOLDS_1_2_ADDR A:0x5020c4
y.create.l HWIO_PCNOC_TPRB1_TPROF_OVERFLOWSTATUS_ADDR A:0x5020ec
y.create.l HWIO_PCNOC_TPRB1_TPROF_OVERFLOWRESET_ADDR A:0x5020f0
y.create.l HWIO_PCNOC_TPRB1_TPROF_PENDINGEVENTMODE_ADDR A:0x5020f4
y.create.l HWIO_PCNOC_TPRB1_TPROF_PRESCALER_ADDR A:0x5020f8
y.create.l HWIO_PCNOC_EPRB0_SPROF_ID_COREID_ADDR A:0x503000
y.create.l HWIO_PCNOC_EPRB0_SPROF_ID_REVISIONID_ADDR A:0x503004
y.create.l HWIO_PCNOC_EPRB0_SPROF_MAINCTL_ADDR A:0x503008
y.create.l HWIO_PCNOC_EPRB0_SPROF_CFGCTL_ADDR A:0x50300c
y.create.l HWIO_PCNOC_EPRB0_SPROF_TRACEPORTSEL_ADDR A:0x503010
y.create.l HWIO_PCNOC_EPRB0_SPROF_FILTERLUT_ADDR A:0x503014
y.create.l HWIO_PCNOC_EPRB0_SPROF_TRACEALARMEN_ADDR A:0x503018
y.create.l HWIO_PCNOC_EPRB0_SPROF_TRACEALARMSTATUS_ADDR A:0x50301c
y.create.l HWIO_PCNOC_EPRB0_SPROF_TRACEALARMCLR_ADDR A:0x503020
y.create.l HWIO_PCNOC_EPRB0_SPROF_STATPERIOD_ADDR A:0x503024
y.create.l HWIO_PCNOC_EPRB0_SPROF_STATGO_ADDR A:0x503028
y.create.l HWIO_PCNOC_EPRB0_SPROF_STATALARMMIN_ADDR A:0x50302c
y.create.l HWIO_PCNOC_EPRB0_SPROF_STATALARMMAX_ADDR A:0x503030
y.create.l HWIO_PCNOC_EPRB0_SPROF_STATALARMSTATUS_ADDR A:0x503034
y.create.l HWIO_PCNOC_EPRB0_SPROF_STATALARMCLR_ADDR A:0x503038
y.create.l HWIO_PCNOC_EPRB0_SPROF_STATALARMEN_ADDR A:0x50303c
y.create.l HWIO_PCNOC_EPRB0_SPROF_FILTERS_0_ROUTEIDBASE_ADDR A:0x503044
y.create.l HWIO_PCNOC_EPRB0_SPROF_FILTERS_0_ROUTEIDMASK_ADDR A:0x503048
y.create.l HWIO_PCNOC_EPRB0_SPROF_FILTERS_0_ADDRBASE_LOW_ADDR A:0x50304c
y.create.l HWIO_PCNOC_EPRB0_SPROF_FILTERS_0_ADDRBASE_HIGH_ADDR A:0x503050
y.create.l HWIO_PCNOC_EPRB0_SPROF_FILTERS_0_WINDOWSIZE_ADDR A:0x503054
y.create.l HWIO_PCNOC_EPRB0_SPROF_FILTERS_0_OPCODE_ADDR A:0x503060
y.create.l HWIO_PCNOC_EPRB0_SPROF_FILTERS_0_STATUS_ADDR A:0x503064
y.create.l HWIO_PCNOC_EPRB0_SPROF_FILTERS_0_LENGTH_ADDR A:0x503068
y.create.l HWIO_PCNOC_EPRB0_SPROF_FILTERS_0_URGENCY_ADDR A:0x50306c
y.create.l HWIO_PCNOC_EPRB0_SPROF_FILTERS_1_ROUTEIDBASE_ADDR A:0x503080
y.create.l HWIO_PCNOC_EPRB0_SPROF_FILTERS_1_ROUTEIDMASK_ADDR A:0x503084
y.create.l HWIO_PCNOC_EPRB0_SPROF_FILTERS_1_ADDRBASE_LOW_ADDR A:0x503088
y.create.l HWIO_PCNOC_EPRB0_SPROF_FILTERS_1_ADDRBASE_HIGH_ADDR A:0x50308c
y.create.l HWIO_PCNOC_EPRB0_SPROF_FILTERS_1_WINDOWSIZE_ADDR A:0x503090
y.create.l HWIO_PCNOC_EPRB0_SPROF_FILTERS_1_OPCODE_ADDR A:0x50309c
y.create.l HWIO_PCNOC_EPRB0_SPROF_FILTERS_1_STATUS_ADDR A:0x5030a0
y.create.l HWIO_PCNOC_EPRB0_SPROF_FILTERS_1_LENGTH_ADDR A:0x5030a4
y.create.l HWIO_PCNOC_EPRB0_SPROF_FILTERS_1_URGENCY_ADDR A:0x5030a8
y.create.l HWIO_PCNOC_EPRB0_SPROF_FILTERS_2_ROUTEIDBASE_ADDR A:0x5030bc
y.create.l HWIO_PCNOC_EPRB0_SPROF_FILTERS_2_ROUTEIDMASK_ADDR A:0x5030c0
y.create.l HWIO_PCNOC_EPRB0_SPROF_FILTERS_2_ADDRBASE_LOW_ADDR A:0x5030c4
y.create.l HWIO_PCNOC_EPRB0_SPROF_FILTERS_2_ADDRBASE_HIGH_ADDR A:0x5030c8
y.create.l HWIO_PCNOC_EPRB0_SPROF_FILTERS_2_WINDOWSIZE_ADDR A:0x5030cc
y.create.l HWIO_PCNOC_EPRB0_SPROF_FILTERS_2_OPCODE_ADDR A:0x5030d8
y.create.l HWIO_PCNOC_EPRB0_SPROF_FILTERS_2_STATUS_ADDR A:0x5030dc
y.create.l HWIO_PCNOC_EPRB0_SPROF_FILTERS_2_LENGTH_ADDR A:0x5030e0
y.create.l HWIO_PCNOC_EPRB0_SPROF_FILTERS_2_URGENCY_ADDR A:0x5030e4
y.create.l HWIO_PCNOC_EPRB0_SPROF_FILTERS_3_ROUTEIDBASE_ADDR A:0x5030f8
y.create.l HWIO_PCNOC_EPRB0_SPROF_FILTERS_3_ROUTEIDMASK_ADDR A:0x5030fc
y.create.l HWIO_PCNOC_EPRB0_SPROF_FILTERS_3_ADDRBASE_LOW_ADDR A:0x503100
y.create.l HWIO_PCNOC_EPRB0_SPROF_FILTERS_3_ADDRBASE_HIGH_ADDR A:0x503104
y.create.l HWIO_PCNOC_EPRB0_SPROF_FILTERS_3_WINDOWSIZE_ADDR A:0x503108
y.create.l HWIO_PCNOC_EPRB0_SPROF_FILTERS_3_OPCODE_ADDR A:0x503114
y.create.l HWIO_PCNOC_EPRB0_SPROF_FILTERS_3_STATUS_ADDR A:0x503118
y.create.l HWIO_PCNOC_EPRB0_SPROF_FILTERS_3_LENGTH_ADDR A:0x50311c
y.create.l HWIO_PCNOC_EPRB0_SPROF_FILTERS_3_URGENCY_ADDR A:0x503120
y.create.l HWIO_PCNOC_EPRB0_SPROF_COUNTERS_0_PORTSEL_ADDR A:0x503134
y.create.l HWIO_PCNOC_EPRB0_SPROF_COUNTERS_0_SRC_ADDR A:0x503138
y.create.l HWIO_PCNOC_EPRB0_SPROF_COUNTERS_0_ALARMMODE_ADDR A:0x50313c
y.create.l HWIO_PCNOC_EPRB0_SPROF_COUNTERS_0_VAL_ADDR A:0x503140
y.create.l HWIO_PCNOC_EPRB0_SPROF_COUNTERS_1_PORTSEL_ADDR A:0x503148
y.create.l HWIO_PCNOC_EPRB0_SPROF_COUNTERS_1_SRC_ADDR A:0x50314c
y.create.l HWIO_PCNOC_EPRB0_SPROF_COUNTERS_1_ALARMMODE_ADDR A:0x503150
y.create.l HWIO_PCNOC_EPRB0_SPROF_COUNTERS_1_VAL_ADDR A:0x503154
y.create.l HWIO_PCNOC_EPRB0_SPROF_COUNTERS_2_PORTSEL_ADDR A:0x50315c
y.create.l HWIO_PCNOC_EPRB0_SPROF_COUNTERS_2_SRC_ADDR A:0x503160
y.create.l HWIO_PCNOC_EPRB0_SPROF_COUNTERS_2_ALARMMODE_ADDR A:0x503164
y.create.l HWIO_PCNOC_EPRB0_SPROF_COUNTERS_2_VAL_ADDR A:0x503168
y.create.l HWIO_PCNOC_EPRB0_SPROF_COUNTERS_3_PORTSEL_ADDR A:0x503170
y.create.l HWIO_PCNOC_EPRB0_SPROF_COUNTERS_3_SRC_ADDR A:0x503174
y.create.l HWIO_PCNOC_EPRB0_SPROF_COUNTERS_3_ALARMMODE_ADDR A:0x503178
y.create.l HWIO_PCNOC_EPRB0_SPROF_COUNTERS_3_VAL_ADDR A:0x50317c
y.create.l HWIO_PCNOC_EPRB0_SPROF_COUNTERS_4_PORTSEL_ADDR A:0x503184
y.create.l HWIO_PCNOC_EPRB0_SPROF_COUNTERS_4_SRC_ADDR A:0x503188
y.create.l HWIO_PCNOC_EPRB0_SPROF_COUNTERS_4_ALARMMODE_ADDR A:0x50318c
y.create.l HWIO_PCNOC_EPRB0_SPROF_COUNTERS_4_VAL_ADDR A:0x503190
y.create.l HWIO_PCNOC_EPRB0_SPROF_COUNTERS_5_PORTSEL_ADDR A:0x503198
y.create.l HWIO_PCNOC_EPRB0_SPROF_COUNTERS_5_SRC_ADDR A:0x50319c
y.create.l HWIO_PCNOC_EPRB0_SPROF_COUNTERS_5_ALARMMODE_ADDR A:0x5031a0
y.create.l HWIO_PCNOC_EPRB0_SPROF_COUNTERS_5_VAL_ADDR A:0x5031a4
y.create.l HWIO_PCNOC_EPRB0_SPROF_COUNTERS_6_PORTSEL_ADDR A:0x5031ac
y.create.l HWIO_PCNOC_EPRB0_SPROF_COUNTERS_6_SRC_ADDR A:0x5031b0
y.create.l HWIO_PCNOC_EPRB0_SPROF_COUNTERS_6_ALARMMODE_ADDR A:0x5031b4
y.create.l HWIO_PCNOC_EPRB0_SPROF_COUNTERS_6_VAL_ADDR A:0x5031b8
y.create.l HWIO_PCNOC_EPRB0_SPROF_COUNTERS_7_PORTSEL_ADDR A:0x5031c0
y.create.l HWIO_PCNOC_EPRB0_SPROF_COUNTERS_7_SRC_ADDR A:0x5031c4
y.create.l HWIO_PCNOC_EPRB0_SPROF_COUNTERS_7_ALARMMODE_ADDR A:0x5031c8
y.create.l HWIO_PCNOC_EPRB0_SPROF_COUNTERS_7_VAL_ADDR A:0x5031cc
y.create.l HWIO_PCNOC_EPRB0_SPROF_COUNTERS_8_PORTSEL_ADDR A:0x5031d4
y.create.l HWIO_PCNOC_EPRB0_SPROF_COUNTERS_8_SRC_ADDR A:0x5031d8
y.create.l HWIO_PCNOC_EPRB0_SPROF_COUNTERS_8_ALARMMODE_ADDR A:0x5031dc
y.create.l HWIO_PCNOC_EPRB0_SPROF_COUNTERS_8_VAL_ADDR A:0x5031e0
y.create.l HWIO_PCNOC_EPRB0_SPROF_COUNTERS_9_PORTSEL_ADDR A:0x5031e8
y.create.l HWIO_PCNOC_EPRB0_SPROF_COUNTERS_9_SRC_ADDR A:0x5031ec
y.create.l HWIO_PCNOC_EPRB0_SPROF_COUNTERS_9_ALARMMODE_ADDR A:0x5031f0
y.create.l HWIO_PCNOC_EPRB0_SPROF_COUNTERS_9_VAL_ADDR A:0x5031f4
y.create.l HWIO_PCNOC_EPRB1_SPROF_ID_COREID_ADDR A:0x503400
y.create.l HWIO_PCNOC_EPRB1_SPROF_ID_REVISIONID_ADDR A:0x503404
y.create.l HWIO_PCNOC_EPRB1_SPROF_MAINCTL_ADDR A:0x503408
y.create.l HWIO_PCNOC_EPRB1_SPROF_CFGCTL_ADDR A:0x50340c
y.create.l HWIO_PCNOC_EPRB1_SPROF_TRACEPORTSEL_ADDR A:0x503410
y.create.l HWIO_PCNOC_EPRB1_SPROF_FILTERLUT_ADDR A:0x503414
y.create.l HWIO_PCNOC_EPRB1_SPROF_TRACEALARMEN_ADDR A:0x503418
y.create.l HWIO_PCNOC_EPRB1_SPROF_TRACEALARMSTATUS_ADDR A:0x50341c
y.create.l HWIO_PCNOC_EPRB1_SPROF_TRACEALARMCLR_ADDR A:0x503420
y.create.l HWIO_PCNOC_EPRB1_SPROF_STATPERIOD_ADDR A:0x503424
y.create.l HWIO_PCNOC_EPRB1_SPROF_STATGO_ADDR A:0x503428
y.create.l HWIO_PCNOC_EPRB1_SPROF_STATALARMMIN_ADDR A:0x50342c
y.create.l HWIO_PCNOC_EPRB1_SPROF_STATALARMMAX_ADDR A:0x503430
y.create.l HWIO_PCNOC_EPRB1_SPROF_STATALARMSTATUS_ADDR A:0x503434
y.create.l HWIO_PCNOC_EPRB1_SPROF_STATALARMCLR_ADDR A:0x503438
y.create.l HWIO_PCNOC_EPRB1_SPROF_STATALARMEN_ADDR A:0x50343c
y.create.l HWIO_PCNOC_EPRB1_SPROF_FILTERS_0_ROUTEIDBASE_ADDR A:0x503444
y.create.l HWIO_PCNOC_EPRB1_SPROF_FILTERS_0_ROUTEIDMASK_ADDR A:0x503448
y.create.l HWIO_PCNOC_EPRB1_SPROF_FILTERS_0_ADDRBASE_LOW_ADDR A:0x50344c
y.create.l HWIO_PCNOC_EPRB1_SPROF_FILTERS_0_ADDRBASE_HIGH_ADDR A:0x503450
y.create.l HWIO_PCNOC_EPRB1_SPROF_FILTERS_0_WINDOWSIZE_ADDR A:0x503454
y.create.l HWIO_PCNOC_EPRB1_SPROF_FILTERS_0_OPCODE_ADDR A:0x503460
y.create.l HWIO_PCNOC_EPRB1_SPROF_FILTERS_0_STATUS_ADDR A:0x503464
y.create.l HWIO_PCNOC_EPRB1_SPROF_FILTERS_0_LENGTH_ADDR A:0x503468
y.create.l HWIO_PCNOC_EPRB1_SPROF_FILTERS_0_URGENCY_ADDR A:0x50346c
y.create.l HWIO_PCNOC_EPRB1_SPROF_FILTERS_1_ROUTEIDBASE_ADDR A:0x503480
y.create.l HWIO_PCNOC_EPRB1_SPROF_FILTERS_1_ROUTEIDMASK_ADDR A:0x503484
y.create.l HWIO_PCNOC_EPRB1_SPROF_FILTERS_1_ADDRBASE_LOW_ADDR A:0x503488
y.create.l HWIO_PCNOC_EPRB1_SPROF_FILTERS_1_ADDRBASE_HIGH_ADDR A:0x50348c
y.create.l HWIO_PCNOC_EPRB1_SPROF_FILTERS_1_WINDOWSIZE_ADDR A:0x503490
y.create.l HWIO_PCNOC_EPRB1_SPROF_FILTERS_1_OPCODE_ADDR A:0x50349c
y.create.l HWIO_PCNOC_EPRB1_SPROF_FILTERS_1_STATUS_ADDR A:0x5034a0
y.create.l HWIO_PCNOC_EPRB1_SPROF_FILTERS_1_LENGTH_ADDR A:0x5034a4
y.create.l HWIO_PCNOC_EPRB1_SPROF_FILTERS_1_URGENCY_ADDR A:0x5034a8
y.create.l HWIO_PCNOC_EPRB1_SPROF_FILTERS_2_ROUTEIDBASE_ADDR A:0x5034bc
y.create.l HWIO_PCNOC_EPRB1_SPROF_FILTERS_2_ROUTEIDMASK_ADDR A:0x5034c0
y.create.l HWIO_PCNOC_EPRB1_SPROF_FILTERS_2_ADDRBASE_LOW_ADDR A:0x5034c4
y.create.l HWIO_PCNOC_EPRB1_SPROF_FILTERS_2_ADDRBASE_HIGH_ADDR A:0x5034c8
y.create.l HWIO_PCNOC_EPRB1_SPROF_FILTERS_2_WINDOWSIZE_ADDR A:0x5034cc
y.create.l HWIO_PCNOC_EPRB1_SPROF_FILTERS_2_OPCODE_ADDR A:0x5034d8
y.create.l HWIO_PCNOC_EPRB1_SPROF_FILTERS_2_STATUS_ADDR A:0x5034dc
y.create.l HWIO_PCNOC_EPRB1_SPROF_FILTERS_2_LENGTH_ADDR A:0x5034e0
y.create.l HWIO_PCNOC_EPRB1_SPROF_FILTERS_2_URGENCY_ADDR A:0x5034e4
y.create.l HWIO_PCNOC_EPRB1_SPROF_FILTERS_3_ROUTEIDBASE_ADDR A:0x5034f8
y.create.l HWIO_PCNOC_EPRB1_SPROF_FILTERS_3_ROUTEIDMASK_ADDR A:0x5034fc
y.create.l HWIO_PCNOC_EPRB1_SPROF_FILTERS_3_ADDRBASE_LOW_ADDR A:0x503500
y.create.l HWIO_PCNOC_EPRB1_SPROF_FILTERS_3_ADDRBASE_HIGH_ADDR A:0x503504
y.create.l HWIO_PCNOC_EPRB1_SPROF_FILTERS_3_WINDOWSIZE_ADDR A:0x503508
y.create.l HWIO_PCNOC_EPRB1_SPROF_FILTERS_3_OPCODE_ADDR A:0x503514
y.create.l HWIO_PCNOC_EPRB1_SPROF_FILTERS_3_STATUS_ADDR A:0x503518
y.create.l HWIO_PCNOC_EPRB1_SPROF_FILTERS_3_LENGTH_ADDR A:0x50351c
y.create.l HWIO_PCNOC_EPRB1_SPROF_FILTERS_3_URGENCY_ADDR A:0x503520
y.create.l HWIO_PCNOC_EPRB1_SPROF_COUNTERS_0_PORTSEL_ADDR A:0x503534
y.create.l HWIO_PCNOC_EPRB1_SPROF_COUNTERS_0_SRC_ADDR A:0x503538
y.create.l HWIO_PCNOC_EPRB1_SPROF_COUNTERS_0_ALARMMODE_ADDR A:0x50353c
y.create.l HWIO_PCNOC_EPRB1_SPROF_COUNTERS_0_VAL_ADDR A:0x503540
y.create.l HWIO_PCNOC_EPRB1_SPROF_COUNTERS_1_PORTSEL_ADDR A:0x503548
y.create.l HWIO_PCNOC_EPRB1_SPROF_COUNTERS_1_SRC_ADDR A:0x50354c
y.create.l HWIO_PCNOC_EPRB1_SPROF_COUNTERS_1_ALARMMODE_ADDR A:0x503550
y.create.l HWIO_PCNOC_EPRB1_SPROF_COUNTERS_1_VAL_ADDR A:0x503554
y.create.l HWIO_PCNOC_EPRB1_SPROF_COUNTERS_2_PORTSEL_ADDR A:0x50355c
y.create.l HWIO_PCNOC_EPRB1_SPROF_COUNTERS_2_SRC_ADDR A:0x503560
y.create.l HWIO_PCNOC_EPRB1_SPROF_COUNTERS_2_ALARMMODE_ADDR A:0x503564
y.create.l HWIO_PCNOC_EPRB1_SPROF_COUNTERS_2_VAL_ADDR A:0x503568
y.create.l HWIO_PCNOC_EPRB1_SPROF_COUNTERS_3_PORTSEL_ADDR A:0x503570
y.create.l HWIO_PCNOC_EPRB1_SPROF_COUNTERS_3_SRC_ADDR A:0x503574
y.create.l HWIO_PCNOC_EPRB1_SPROF_COUNTERS_3_ALARMMODE_ADDR A:0x503578
y.create.l HWIO_PCNOC_EPRB1_SPROF_COUNTERS_3_VAL_ADDR A:0x50357c
y.create.l HWIO_PCNOC_EPRB1_SPROF_COUNTERS_4_PORTSEL_ADDR A:0x503584
y.create.l HWIO_PCNOC_EPRB1_SPROF_COUNTERS_4_SRC_ADDR A:0x503588
y.create.l HWIO_PCNOC_EPRB1_SPROF_COUNTERS_4_ALARMMODE_ADDR A:0x50358c
y.create.l HWIO_PCNOC_EPRB1_SPROF_COUNTERS_4_VAL_ADDR A:0x503590
y.create.l HWIO_PCNOC_EPRB1_SPROF_COUNTERS_5_PORTSEL_ADDR A:0x503598
y.create.l HWIO_PCNOC_EPRB1_SPROF_COUNTERS_5_SRC_ADDR A:0x50359c
y.create.l HWIO_PCNOC_EPRB1_SPROF_COUNTERS_5_ALARMMODE_ADDR A:0x5035a0
y.create.l HWIO_PCNOC_EPRB1_SPROF_COUNTERS_5_VAL_ADDR A:0x5035a4
y.create.l HWIO_PCNOC_EPRB1_SPROF_COUNTERS_6_PORTSEL_ADDR A:0x5035ac
y.create.l HWIO_PCNOC_EPRB1_SPROF_COUNTERS_6_SRC_ADDR A:0x5035b0
y.create.l HWIO_PCNOC_EPRB1_SPROF_COUNTERS_6_ALARMMODE_ADDR A:0x5035b4
y.create.l HWIO_PCNOC_EPRB1_SPROF_COUNTERS_6_VAL_ADDR A:0x5035b8
y.create.l HWIO_PCNOC_EPRB1_SPROF_COUNTERS_7_PORTSEL_ADDR A:0x5035c0
y.create.l HWIO_PCNOC_EPRB1_SPROF_COUNTERS_7_SRC_ADDR A:0x5035c4
y.create.l HWIO_PCNOC_EPRB1_SPROF_COUNTERS_7_ALARMMODE_ADDR A:0x5035c8
y.create.l HWIO_PCNOC_EPRB1_SPROF_COUNTERS_7_VAL_ADDR A:0x5035cc
y.create.l HWIO_PCNOC_EPRB1_SPROF_COUNTERS_8_PORTSEL_ADDR A:0x5035d4
y.create.l HWIO_PCNOC_EPRB1_SPROF_COUNTERS_8_SRC_ADDR A:0x5035d8
y.create.l HWIO_PCNOC_EPRB1_SPROF_COUNTERS_8_ALARMMODE_ADDR A:0x5035dc
y.create.l HWIO_PCNOC_EPRB1_SPROF_COUNTERS_8_VAL_ADDR A:0x5035e0
y.create.l HWIO_PCNOC_EPRB1_SPROF_COUNTERS_9_PORTSEL_ADDR A:0x5035e8
y.create.l HWIO_PCNOC_EPRB1_SPROF_COUNTERS_9_SRC_ADDR A:0x5035ec
y.create.l HWIO_PCNOC_EPRB1_SPROF_COUNTERS_9_ALARMMODE_ADDR A:0x5035f0
y.create.l HWIO_PCNOC_EPRB1_SPROF_COUNTERS_9_VAL_ADDR A:0x5035f4
y.create.l HWIO_PCNOC_TPRB0_SPROF_ID_COREID_ADDR A:0x504000
y.create.l HWIO_PCNOC_TPRB0_SPROF_ID_REVISIONID_ADDR A:0x504004
y.create.l HWIO_PCNOC_TPRB0_SPROF_MAINCTL_ADDR A:0x504008
y.create.l HWIO_PCNOC_TPRB0_SPROF_CFGCTL_ADDR A:0x50400c
y.create.l HWIO_PCNOC_TPRB0_SPROF_STATPERIOD_ADDR A:0x504024
y.create.l HWIO_PCNOC_TPRB0_SPROF_STATGO_ADDR A:0x504028
y.create.l HWIO_PCNOC_TPRB0_SPROF_STATALARMMIN_ADDR A:0x50402c
y.create.l HWIO_PCNOC_TPRB0_SPROF_STATALARMMAX_ADDR A:0x504030
y.create.l HWIO_PCNOC_TPRB0_SPROF_STATALARMSTATUS_ADDR A:0x504034
y.create.l HWIO_PCNOC_TPRB0_SPROF_STATALARMCLR_ADDR A:0x504038
y.create.l HWIO_PCNOC_TPRB0_SPROF_STATALARMEN_ADDR A:0x50403c
y.create.l HWIO_PCNOC_TPRB0_SPROF_COUNTERS_0_SRC_ADDR A:0x504138
y.create.l HWIO_PCNOC_TPRB0_SPROF_COUNTERS_0_ALARMMODE_ADDR A:0x50413c
y.create.l HWIO_PCNOC_TPRB0_SPROF_COUNTERS_0_VAL_ADDR A:0x504140
y.create.l HWIO_PCNOC_TPRB0_SPROF_COUNTERS_1_SRC_ADDR A:0x50414c
y.create.l HWIO_PCNOC_TPRB0_SPROF_COUNTERS_1_ALARMMODE_ADDR A:0x504150
y.create.l HWIO_PCNOC_TPRB0_SPROF_COUNTERS_1_VAL_ADDR A:0x504154
y.create.l HWIO_PCNOC_TPRB0_SPROF_COUNTERS_2_SRC_ADDR A:0x504160
y.create.l HWIO_PCNOC_TPRB0_SPROF_COUNTERS_2_ALARMMODE_ADDR A:0x504164
y.create.l HWIO_PCNOC_TPRB0_SPROF_COUNTERS_2_VAL_ADDR A:0x504168
y.create.l HWIO_PCNOC_TPRB0_SPROF_COUNTERS_3_SRC_ADDR A:0x504174
y.create.l HWIO_PCNOC_TPRB0_SPROF_COUNTERS_3_ALARMMODE_ADDR A:0x504178
y.create.l HWIO_PCNOC_TPRB0_SPROF_COUNTERS_3_VAL_ADDR A:0x50417c
y.create.l HWIO_PCNOC_TPRB0_SPROF_COUNTERS_4_SRC_ADDR A:0x504188
y.create.l HWIO_PCNOC_TPRB0_SPROF_COUNTERS_4_ALARMMODE_ADDR A:0x50418c
y.create.l HWIO_PCNOC_TPRB0_SPROF_COUNTERS_4_VAL_ADDR A:0x504190
y.create.l HWIO_PCNOC_TPRB0_SPROF_COUNTERS_5_SRC_ADDR A:0x50419c
y.create.l HWIO_PCNOC_TPRB0_SPROF_COUNTERS_5_ALARMMODE_ADDR A:0x5041a0
y.create.l HWIO_PCNOC_TPRB0_SPROF_COUNTERS_5_VAL_ADDR A:0x5041a4
y.create.l HWIO_PCNOC_TPRB0_SPROF_COUNTERS_6_SRC_ADDR A:0x5041b0
y.create.l HWIO_PCNOC_TPRB0_SPROF_COUNTERS_6_ALARMMODE_ADDR A:0x5041b4
y.create.l HWIO_PCNOC_TPRB0_SPROF_COUNTERS_6_VAL_ADDR A:0x5041b8
y.create.l HWIO_PCNOC_TPRB0_SPROF_COUNTERS_7_SRC_ADDR A:0x5041c4
y.create.l HWIO_PCNOC_TPRB0_SPROF_COUNTERS_7_ALARMMODE_ADDR A:0x5041c8
y.create.l HWIO_PCNOC_TPRB0_SPROF_COUNTERS_7_VAL_ADDR A:0x5041cc
y.create.l HWIO_PCNOC_TPRB0_SPROF_COUNTERS_8_SRC_ADDR A:0x5041d8
y.create.l HWIO_PCNOC_TPRB0_SPROF_COUNTERS_8_ALARMMODE_ADDR A:0x5041dc
y.create.l HWIO_PCNOC_TPRB0_SPROF_COUNTERS_8_VAL_ADDR A:0x5041e0
y.create.l HWIO_PCNOC_TPRB0_SPROF_COUNTERS_9_SRC_ADDR A:0x5041ec
y.create.l HWIO_PCNOC_TPRB0_SPROF_COUNTERS_9_ALARMMODE_ADDR A:0x5041f0
y.create.l HWIO_PCNOC_TPRB0_SPROF_COUNTERS_9_VAL_ADDR A:0x5041f4
y.create.l HWIO_PCNOC_TPRB0_SPROF_COUNTERS_10_SRC_ADDR A:0x504200
y.create.l HWIO_PCNOC_TPRB0_SPROF_COUNTERS_10_ALARMMODE_ADDR A:0x504204
y.create.l HWIO_PCNOC_TPRB0_SPROF_COUNTERS_10_VAL_ADDR A:0x504208
y.create.l HWIO_PCNOC_TPRB0_SPROF_COUNTERS_11_SRC_ADDR A:0x504214
y.create.l HWIO_PCNOC_TPRB0_SPROF_COUNTERS_11_ALARMMODE_ADDR A:0x504218
y.create.l HWIO_PCNOC_TPRB0_SPROF_COUNTERS_11_VAL_ADDR A:0x50421c
y.create.l HWIO_PCNOC_TPRB0_SPROF_COUNTERS_12_SRC_ADDR A:0x504228
y.create.l HWIO_PCNOC_TPRB0_SPROF_COUNTERS_12_ALARMMODE_ADDR A:0x50422c
y.create.l HWIO_PCNOC_TPRB0_SPROF_COUNTERS_12_VAL_ADDR A:0x504230
y.create.l HWIO_PCNOC_TPRB0_SPROF_COUNTERS_13_SRC_ADDR A:0x50423c
y.create.l HWIO_PCNOC_TPRB0_SPROF_COUNTERS_13_ALARMMODE_ADDR A:0x504240
y.create.l HWIO_PCNOC_TPRB0_SPROF_COUNTERS_13_VAL_ADDR A:0x504244
y.create.l HWIO_PCNOC_TPRB0_SPROF_COUNTERS_14_SRC_ADDR A:0x504250
y.create.l HWIO_PCNOC_TPRB0_SPROF_COUNTERS_14_ALARMMODE_ADDR A:0x504254
y.create.l HWIO_PCNOC_TPRB0_SPROF_COUNTERS_14_VAL_ADDR A:0x504258
y.create.l HWIO_PCNOC_TPRB0_SPROF_COUNTERS_15_SRC_ADDR A:0x504264
y.create.l HWIO_PCNOC_TPRB0_SPROF_COUNTERS_15_ALARMMODE_ADDR A:0x504268
y.create.l HWIO_PCNOC_TPRB0_SPROF_COUNTERS_15_VAL_ADDR A:0x50426c
y.create.l HWIO_PCNOC_TPRB1_SPROF_ID_COREID_ADDR A:0x504400
y.create.l HWIO_PCNOC_TPRB1_SPROF_ID_REVISIONID_ADDR A:0x504404
y.create.l HWIO_PCNOC_TPRB1_SPROF_MAINCTL_ADDR A:0x504408
y.create.l HWIO_PCNOC_TPRB1_SPROF_CFGCTL_ADDR A:0x50440c
y.create.l HWIO_PCNOC_TPRB1_SPROF_STATPERIOD_ADDR A:0x504424
y.create.l HWIO_PCNOC_TPRB1_SPROF_STATGO_ADDR A:0x504428
y.create.l HWIO_PCNOC_TPRB1_SPROF_STATALARMMIN_ADDR A:0x50442c
y.create.l HWIO_PCNOC_TPRB1_SPROF_STATALARMMAX_ADDR A:0x504430
y.create.l HWIO_PCNOC_TPRB1_SPROF_STATALARMSTATUS_ADDR A:0x504434
y.create.l HWIO_PCNOC_TPRB1_SPROF_STATALARMCLR_ADDR A:0x504438
y.create.l HWIO_PCNOC_TPRB1_SPROF_STATALARMEN_ADDR A:0x50443c
y.create.l HWIO_PCNOC_TPRB1_SPROF_COUNTERS_0_SRC_ADDR A:0x504538
y.create.l HWIO_PCNOC_TPRB1_SPROF_COUNTERS_0_ALARMMODE_ADDR A:0x50453c
y.create.l HWIO_PCNOC_TPRB1_SPROF_COUNTERS_0_VAL_ADDR A:0x504540
y.create.l HWIO_PCNOC_TPRB1_SPROF_COUNTERS_1_SRC_ADDR A:0x50454c
y.create.l HWIO_PCNOC_TPRB1_SPROF_COUNTERS_1_ALARMMODE_ADDR A:0x504550
y.create.l HWIO_PCNOC_TPRB1_SPROF_COUNTERS_1_VAL_ADDR A:0x504554
y.create.l HWIO_PCNOC_TPRB1_SPROF_COUNTERS_2_SRC_ADDR A:0x504560
y.create.l HWIO_PCNOC_TPRB1_SPROF_COUNTERS_2_ALARMMODE_ADDR A:0x504564
y.create.l HWIO_PCNOC_TPRB1_SPROF_COUNTERS_2_VAL_ADDR A:0x504568
y.create.l HWIO_PCNOC_TPRB1_SPROF_COUNTERS_3_SRC_ADDR A:0x504574
y.create.l HWIO_PCNOC_TPRB1_SPROF_COUNTERS_3_ALARMMODE_ADDR A:0x504578
y.create.l HWIO_PCNOC_TPRB1_SPROF_COUNTERS_3_VAL_ADDR A:0x50457c
y.create.l HWIO_PCNOC_TPRB1_SPROF_COUNTERS_4_SRC_ADDR A:0x504588
y.create.l HWIO_PCNOC_TPRB1_SPROF_COUNTERS_4_ALARMMODE_ADDR A:0x50458c
y.create.l HWIO_PCNOC_TPRB1_SPROF_COUNTERS_4_VAL_ADDR A:0x504590
y.create.l HWIO_PCNOC_TPRB1_SPROF_COUNTERS_5_SRC_ADDR A:0x50459c
y.create.l HWIO_PCNOC_TPRB1_SPROF_COUNTERS_5_ALARMMODE_ADDR A:0x5045a0
y.create.l HWIO_PCNOC_TPRB1_SPROF_COUNTERS_5_VAL_ADDR A:0x5045a4
y.create.l HWIO_PCNOC_TPRB1_SPROF_COUNTERS_6_SRC_ADDR A:0x5045b0
y.create.l HWIO_PCNOC_TPRB1_SPROF_COUNTERS_6_ALARMMODE_ADDR A:0x5045b4
y.create.l HWIO_PCNOC_TPRB1_SPROF_COUNTERS_6_VAL_ADDR A:0x5045b8
y.create.l HWIO_PCNOC_TPRB1_SPROF_COUNTERS_7_SRC_ADDR A:0x5045c4
y.create.l HWIO_PCNOC_TPRB1_SPROF_COUNTERS_7_ALARMMODE_ADDR A:0x5045c8
y.create.l HWIO_PCNOC_TPRB1_SPROF_COUNTERS_7_VAL_ADDR A:0x5045cc
y.create.l HWIO_PCNOC_TPRB1_SPROF_COUNTERS_8_SRC_ADDR A:0x5045d8
y.create.l HWIO_PCNOC_TPRB1_SPROF_COUNTERS_8_ALARMMODE_ADDR A:0x5045dc
y.create.l HWIO_PCNOC_TPRB1_SPROF_COUNTERS_8_VAL_ADDR A:0x5045e0
y.create.l HWIO_PCNOC_TPRB1_SPROF_COUNTERS_9_SRC_ADDR A:0x5045ec
y.create.l HWIO_PCNOC_TPRB1_SPROF_COUNTERS_9_ALARMMODE_ADDR A:0x5045f0
y.create.l HWIO_PCNOC_TPRB1_SPROF_COUNTERS_9_VAL_ADDR A:0x5045f4
y.create.l HWIO_PCNOC_TPRB1_SPROF_COUNTERS_10_SRC_ADDR A:0x504600
y.create.l HWIO_PCNOC_TPRB1_SPROF_COUNTERS_10_ALARMMODE_ADDR A:0x504604
y.create.l HWIO_PCNOC_TPRB1_SPROF_COUNTERS_10_VAL_ADDR A:0x504608
y.create.l HWIO_PCNOC_TPRB1_SPROF_COUNTERS_11_SRC_ADDR A:0x504614
y.create.l HWIO_PCNOC_TPRB1_SPROF_COUNTERS_11_ALARMMODE_ADDR A:0x504618
y.create.l HWIO_PCNOC_TPRB1_SPROF_COUNTERS_11_VAL_ADDR A:0x50461c
y.create.l HWIO_PCNOC_TPRB1_SPROF_COUNTERS_12_SRC_ADDR A:0x504628
y.create.l HWIO_PCNOC_TPRB1_SPROF_COUNTERS_12_ALARMMODE_ADDR A:0x50462c
y.create.l HWIO_PCNOC_TPRB1_SPROF_COUNTERS_12_VAL_ADDR A:0x504630
y.create.l HWIO_PCNOC_TPRB1_SPROF_COUNTERS_13_SRC_ADDR A:0x50463c
y.create.l HWIO_PCNOC_TPRB1_SPROF_COUNTERS_13_ALARMMODE_ADDR A:0x504640
y.create.l HWIO_PCNOC_TPRB1_SPROF_COUNTERS_13_VAL_ADDR A:0x504644
y.create.l HWIO_PCNOC_TPRB1_SPROF_COUNTERS_14_SRC_ADDR A:0x504650
y.create.l HWIO_PCNOC_TPRB1_SPROF_COUNTERS_14_ALARMMODE_ADDR A:0x504654
y.create.l HWIO_PCNOC_TPRB1_SPROF_COUNTERS_14_VAL_ADDR A:0x504658
y.create.l HWIO_PCNOC_TPRB1_SPROF_COUNTERS_15_SRC_ADDR A:0x504664
y.create.l HWIO_PCNOC_TPRB1_SPROF_COUNTERS_15_ALARMMODE_ADDR A:0x504668
y.create.l HWIO_PCNOC_TPRB1_SPROF_COUNTERS_15_VAL_ADDR A:0x50466c
y.create.l HWIO_PCNOC_CRYPTO0_QOS_ID_COREID_ADDR A:0x507000
y.create.l HWIO_PCNOC_CRYPTO0_QOS_ID_REVISIONID_ADDR A:0x507004
y.create.l HWIO_PCNOC_CRYPTO0_QOS_PRIORITY_ADDR A:0x507008
y.create.l HWIO_PCNOC_CRYPTO0_QOS_MODE_ADDR A:0x50700c
y.create.l HWIO_PCNOC_CRYPTO0_QOS_EXTCONTROL_ADDR A:0x507018
y.create.l HWIO_PCNOC_QHM1_QOS_ID_COREID_ADDR A:0x50c000
y.create.l HWIO_PCNOC_QHM1_QOS_ID_REVISIONID_ADDR A:0x50c004
y.create.l HWIO_PCNOC_QHM1_QOS_PRIORITY_ADDR A:0x50c008
y.create.l HWIO_PCNOC_QHM1_QOS_MODE_ADDR A:0x50c00c
y.create.l HWIO_PCNOC_QHM1_QOS_EXTCONTROL_ADDR A:0x50c018
y.create.l HWIO_PCNOC_QHM2_QOS_ID_COREID_ADDR A:0x50d000
y.create.l HWIO_PCNOC_QHM2_QOS_ID_REVISIONID_ADDR A:0x50d004
y.create.l HWIO_PCNOC_QHM2_QOS_PRIORITY_ADDR A:0x50d008
y.create.l HWIO_PCNOC_QHM2_QOS_MODE_ADDR A:0x50d00c
y.create.l HWIO_PCNOC_QHM2_QOS_EXTCONTROL_ADDR A:0x50d018
y.create.l HWIO_PCNOC_SDC1_QOS_ID_COREID_ADDR A:0x50e000
y.create.l HWIO_PCNOC_SDC1_QOS_ID_REVISIONID_ADDR A:0x50e004
y.create.l HWIO_PCNOC_SDC1_QOS_PRIORITY_ADDR A:0x50e008
y.create.l HWIO_PCNOC_SDC1_QOS_MODE_ADDR A:0x50e00c
y.create.l HWIO_PCNOC_SDC1_QOS_EXTCONTROL_ADDR A:0x50e018
y.create.l HWIO_PCNOC_SDC2_QOS_ID_COREID_ADDR A:0x50f000
y.create.l HWIO_PCNOC_SDC2_QOS_ID_REVISIONID_ADDR A:0x50f004
y.create.l HWIO_PCNOC_SDC2_QOS_PRIORITY_ADDR A:0x50f008
y.create.l HWIO_PCNOC_SDC2_QOS_MODE_ADDR A:0x50f00c
y.create.l HWIO_PCNOC_SDC2_QOS_EXTCONTROL_ADDR A:0x50f018
y.create.l HWIO_PCNOC_QXM_NOC_QOS_ID_COREID_ADDR A:0x510000
y.create.l HWIO_PCNOC_QXM_NOC_QOS_ID_REVISIONID_ADDR A:0x510004
y.create.l HWIO_PCNOC_QXM_NOC_QOS_PRIORITY_ADDR A:0x510008
y.create.l HWIO_PCNOC_QXM_NOC_QOS_MODE_ADDR A:0x51000c
y.create.l HWIO_PCNOC_QXM_NOC_QOS_EXTCONTROL_ADDR A:0x510018
y.create.l HWIO_PCNOC_SGMI_QOS_ID_COREID_ADDR A:0x511000
y.create.l HWIO_PCNOC_SGMI_QOS_ID_REVISIONID_ADDR A:0x511004
y.create.l HWIO_PCNOC_SGMI_QOS_PRIORITY_ADDR A:0x511008
y.create.l HWIO_PCNOC_SGMI_QOS_MODE_ADDR A:0x51100c
y.create.l HWIO_PCNOC_SGMI_QOS_EXTCONTROL_ADDR A:0x511018
y.create.l HWIO_PCNOC_HSIC_QOS_ID_COREID_ADDR A:0x512000
y.create.l HWIO_PCNOC_HSIC_QOS_ID_REVISIONID_ADDR A:0x512004
y.create.l HWIO_PCNOC_HSIC_QOS_PRIORITY_ADDR A:0x512008
y.create.l HWIO_PCNOC_HSIC_QOS_MODE_ADDR A:0x51200c
y.create.l HWIO_PCNOC_HSIC_QOS_EXTCONTROL_ADDR A:0x512018
y.create.l HWIO_PCNOC_USB_HS1_QOS_ID_COREID_ADDR A:0x513000
y.create.l HWIO_PCNOC_USB_HS1_QOS_ID_REVISIONID_ADDR A:0x513004
y.create.l HWIO_PCNOC_USB_HS1_QOS_PRIORITY_ADDR A:0x513008
y.create.l HWIO_PCNOC_USB_HS1_QOS_MODE_ADDR A:0x51300c
y.create.l HWIO_PCNOC_USB_HS1_QOS_EXTCONTROL_ADDR A:0x513018
y.create.l HWIO_PCNOC_QDSS_BAM_QOS_ID_COREID_ADDR A:0x514000
y.create.l HWIO_PCNOC_QDSS_BAM_QOS_ID_REVISIONID_ADDR A:0x514004
y.create.l HWIO_PCNOC_QDSS_BAM_QOS_PRIORITY_ADDR A:0x514008
y.create.l HWIO_PCNOC_QDSS_BAM_QOS_MODE_ADDR A:0x51400c
y.create.l HWIO_PCNOC_QDSS_BAM_QOS_EXTCONTROL_ADDR A:0x514018
y.create.l HWIO_PCNOC_QDSS_ETR_QOS_ID_COREID_ADDR A:0x515000
y.create.l HWIO_PCNOC_QDSS_ETR_QOS_ID_REVISIONID_ADDR A:0x515004
y.create.l HWIO_PCNOC_QDSS_ETR_QOS_PRIORITY_ADDR A:0x515008
y.create.l HWIO_PCNOC_QDSS_ETR_QOS_MODE_ADDR A:0x51500c
y.create.l HWIO_PCNOC_QDSS_ETR_QOS_EXTCONTROL_ADDR A:0x515018
y.create.l HWIO_PDM_TCXO_PDM0_TOP_CTL_ADDR A:0x68000
y.create.l HWIO_PDM_PDM0_CTL_ADDR A:0x68004
y.create.l HWIO_PDM_WEB_TCXO4_TEST_ADDR A:0x68008
y.create.l HWIO_PDM_TCXO_PDM1_TOP_CTL_ADDR A:0x69000
y.create.l HWIO_PDM_PDM1_CTL_ADDR A:0x69004
y.create.l HWIO_PDM_TCXO_PDM2_TOP_CTL_ADDR A:0x6a000
y.create.l HWIO_PDM_PDM2_CTL_ADDR A:0x6a004
y.create.l HWIO_PDM_GP_MN_CLK_MDIV_ADDR A:0x6b000
y.create.l HWIO_PDM_GP_MN_CLK_NDIV_ADDR A:0x6b004
y.create.l HWIO_PDM_GP_MN_CLK_DUTY_ADDR A:0x6b008
y.create.l HWIO_SPMI_GENI_CLK_CTRL_ADDR A:0x200a000
y.create.l HWIO_SPMI_GENI_HW_VERSION_ADDR A:0x200a004
y.create.l HWIO_SPMI_GENI_FW_REVISION_ADDR A:0x200a008
y.create.l HWIO_SPMI_GENI_S_FW_REVISION_ADDR A:0x200a00c
y.create.l HWIO_SPMI_GENI_FORCE_DEFAULT_REG_ADDR A:0x200a010
y.create.l HWIO_SPMI_GENI_OUTPUT_CTRL_ADDR A:0x200a014
y.create.l HWIO_SPMI_GENI_CGC_CTRL_ADDR A:0x200a018
y.create.l HWIO_SPMI_GENI_CHAR_CFG_ADDR A:0x200a01c
y.create.l HWIO_SPMI_GENI_CHAR_DATA_0_ADDR A:0x200a020
y.create.l HWIO_SPMI_GENI_CHAR_DATA_1_ADDR A:0x200a024
y.create.l HWIO_SPMI_GENI_CTRL_ADDR A:0x200a028
y.create.l HWIO_SPMI_GENI_STATUS_ADDR A:0x200a02c
y.create.l HWIO_SPMI_GENI_TEST_BUS_CTRL_ADDR A:0x200a030
y.create.l HWIO_SPMI_GENI_SER_CLK_CFG_ADDR A:0x200a034
y.create.l HWIO_SPMI_GENI_TX_WATERMARK_REG_ADDR A:0x200a038
y.create.l HWIO_SPMI_GENI_RX_WATERMARK_REG_ADDR A:0x200a03c
y.create.l HWIO_SPMI_GENI_STOP_REG_ADDR A:0x200a040
y.create.l HWIO_SPMI_GENI_SW_COMP_REG_ADDR A:0x200a044
y.create.l HWIO_SPMI_GENI_PROG_ROM_CTRL_REG_ADDR A:0x200a048
y.create.l HWIO_SPMI_GENI_CFG_REG0_ADDR A:0x200a100
y.create.l HWIO_SPMI_GENI_CFG_REG1_ADDR A:0x200a104
y.create.l HWIO_SPMI_GENI_CFG_REG2_ADDR A:0x200a108
y.create.l HWIO_SPMI_GENI_CFG_REG3_ADDR A:0x200a10c
y.create.l HWIO_SPMI_GENI_CFG_REG4_ADDR A:0x200a110
y.create.l HWIO_SPMI_GENI_CFG_REG5_ADDR A:0x200a114
y.create.l HWIO_SPMI_GENI_CFG_REG6_ADDR A:0x200a118
y.create.l HWIO_SPMI_GENI_CFG_REG7_ADDR A:0x200a11c
y.create.l HWIO_SPMI_GENI_CFG_REG8_ADDR A:0x200a120
y.create.l HWIO_SPMI_GENI_CFG_REG9_ADDR A:0x200a124
y.create.l HWIO_SPMI_GENI_CFG_REG10_ADDR A:0x200a128
y.create.l HWIO_SPMI_GENI_CFG_REG11_ADDR A:0x200a12c
y.create.l HWIO_SPMI_GENI_CFG_REG12_ADDR A:0x200a130
y.create.l HWIO_SPMI_GENI_CFG_REG13_ADDR A:0x200a134
y.create.l HWIO_SPMI_GENI_CFG_REG14_ADDR A:0x200a138
y.create.l HWIO_SPMI_GENI_CFG_REG15_ADDR A:0x200a13c
y.create.l HWIO_SPMI_GENI_CFG_REG16_ADDR A:0x200a140
y.create.l HWIO_SPMI_GENI_CFG_REG17_ADDR A:0x200a144
y.create.l HWIO_SPMI_GENI_CFG_REG18_ADDR A:0x200a148
y.create.l HWIO_SPMI_GENI_CFG_REG19_ADDR A:0x200a14c
y.create.l HWIO_SPMI_GENI_CFG_REG20_ADDR A:0x200a150
y.create.l HWIO_SPMI_GENI_CFG_REG21_ADDR A:0x200a154
y.create.l HWIO_SPMI_GENI_CFG_REG22_ADDR A:0x200a158
y.create.l HWIO_SPMI_GENI_CFG_REG23_ADDR A:0x200a15c
y.create.l HWIO_SPMI_GENI_CFG_REG24_ADDR A:0x200a160
y.create.l HWIO_SPMI_GENI_CFG_REG25_ADDR A:0x200a164
y.create.l HWIO_SPMI_GENI_CFG_REG26_ADDR A:0x200a168
y.create.l HWIO_SPMI_GENI_CFG_REG27_ADDR A:0x200a16c
y.create.l HWIO_SPMI_GENI_CFG_REG28_ADDR A:0x200a170
y.create.l HWIO_SPMI_GENI_CFG_REG29_ADDR A:0x200a174
y.create.l HWIO_SPMI_GENI_CFG_REG30_ADDR A:0x200a178
y.create.l HWIO_SPMI_GENI_CFG_RAM0_ADDR A:0x200a200
y.create.l HWIO_SPMI_GENI_CFG_RAM1_ADDR A:0x200a204
y.create.l HWIO_SPMI_GENI_CFG_RAM2_ADDR A:0x200a208
y.create.l HWIO_SPMI_GENI_CFG_RAM3_ADDR A:0x200a20c
y.create.l HWIO_SPMI_GENI_CFG_RAM4_ADDR A:0x200a210
y.create.l HWIO_SPMI_GENI_CFG_RAM5_ADDR A:0x200a214
y.create.l HWIO_SPMI_GENI_CFG_RAM6_ADDR A:0x200a218
y.create.l HWIO_SPMI_GENI_CFG_RAM7_ADDR A:0x200a21c
y.create.l HWIO_SPMI_GENI_CFG_RAM8_ADDR A:0x200a220
y.create.l HWIO_SPMI_GENI_CFG_RAM9_ADDR A:0x200a224
y.create.l HWIO_SPMI_PERIPH0_2OWNER_TABLE_REG_ADDR A:0x200a700
y.create.l HWIO_SPMI_PERIPH1_2OWNER_TABLE_REG_ADDR A:0x200a704
y.create.l HWIO_SPMI_PERIPH2_2OWNER_TABLE_REG_ADDR A:0x200a708
y.create.l HWIO_SPMI_PERIPH3_2OWNER_TABLE_REG_ADDR A:0x200a70c
y.create.l HWIO_SPMI_PERIPH4_2OWNER_TABLE_REG_ADDR A:0x200a710
y.create.l HWIO_SPMI_PERIPH5_2OWNER_TABLE_REG_ADDR A:0x200a714
y.create.l HWIO_SPMI_PERIPH6_2OWNER_TABLE_REG_ADDR A:0x200a718
y.create.l HWIO_SPMI_PERIPH7_2OWNER_TABLE_REG_ADDR A:0x200a71c
y.create.l HWIO_SPMI_PERIPH8_2OWNER_TABLE_REG_ADDR A:0x200a720
y.create.l HWIO_SPMI_PERIPH9_2OWNER_TABLE_REG_ADDR A:0x200a724
y.create.l HWIO_SPMI_MAPPING_TABLE_REG0_ADDR A:0x200ab00
y.create.l HWIO_SPMI_MAPPING_TABLE_REG1_ADDR A:0x200ab04
y.create.l HWIO_SPMI_MAPPING_TABLE_REG2_ADDR A:0x200ab08
y.create.l HWIO_SPMI_MAPPING_TABLE_REG3_ADDR A:0x200ab0c
y.create.l HWIO_SPMI_MAPPING_TABLE_REG4_ADDR A:0x200ab10
y.create.l HWIO_SPMI_MAPPING_TABLE_REG5_ADDR A:0x200ab14
y.create.l HWIO_SPMI_MAPPING_TABLE_REG6_ADDR A:0x200ab18
y.create.l HWIO_SPMI_MAPPING_TABLE_REG7_ADDR A:0x200ab1c
y.create.l HWIO_SPMI_MAPPING_TABLE_REG8_ADDR A:0x200ab20
y.create.l HWIO_SPMI_MAPPING_TABLE_REG9_ADDR A:0x200ab24
y.create.l HWIO_SPMI_MID_REG_ADDR A:0x200af00
y.create.l HWIO_SPMI_CFG_REG_ADDR A:0x200af04
y.create.l HWIO_SPMI_SEC_DISABLE_REG_ADDR A:0x200af08
y.create.l HWIO_SPMI_HW_VERSION_ADDR A:0x200af0c
y.create.l HWIO_SPMI_CGC_CTRL_ADDR A:0x200af10
y.create.l HWIO_SPMI_MWB_ENABLE_REG_ADDR A:0x200af14
y.create.l HWIO_SPMI_CHAR_CFG_ADDR A:0x200af40
y.create.l HWIO_SPMI_CHAR_DATA_0_ADDR A:0x200af44
y.create.l HWIO_SPMI_CHAR_DATA_1_ADDR A:0x200af48
y.create.l HWIO_SPMI_CMPR_EN_REG_ADDR A:0x200af54
y.create.l HWIO_SPMI_PROTOCOL_IRQ_STATUS_ADDR A:0x200b000
y.create.l HWIO_SPMI_PROTOCOL_IRQ_ENABLE_ADDR A:0x200b004
y.create.l HWIO_SPMI_PROTOCOL_IRQ_CLEAR_ADDR A:0x200b008
y.create.l HWIO_SPMI_PROTOCOL_IRQ_EN_SET_ADDR A:0x200b00c
y.create.l HWIO_SPMI_PROTOCOL_IRQ_EN_CLEAR_ADDR A:0x200b010
y.create.l HWIO_SPMI_TEST_BUS_CTRL_ADDR A:0x200c000
y.create.l HWIO_SPMI_HW_SW_EVENTS_CTRL_ADDR A:0x200c004
y.create.l HWIO_SPMI_HW_SW_EVENTS_BITWISE_REG0_ADDR A:0x200c008
y.create.l HWIO_SPMI_HW_SW_EVENTS_BITWISE_REG1_ADDR A:0x200c00c
y.create.l HWIO_SPMI_HW_SW_EVENTS_BITWISE_REG2_ADDR A:0x200c010
y.create.l HWIO_SPMI_HW_SW_EVENTS_BITWISE_REG3_ADDR A:0x200c014
y.create.l HWIO_SPMI_HW_SW_EVENTS_BITWISE_REG4_ADDR A:0x200c018
y.create.l HWIO_SPMI_HW_SW_EVENTS_BITWISE_REG5_ADDR A:0x200c01c
y.create.l HWIO_SPMI_HW_SW_EVENTS_BITWISE_REG6_ADDR A:0x200c020
y.create.l HWIO_SPMI_HW_SW_EVENTS_BITWISE_REG7_ADDR A:0x200c024
y.create.l HWIO_SPMI_PIC_OWNER0_ACC_STATUS0_ADDR A:0x3900000
y.create.l HWIO_SPMI_PIC_OWNER0_ACC_STATUS1_ADDR A:0x3900004
y.create.l HWIO_SPMI_PIC_OWNER0_ACC_STATUS2_ADDR A:0x3900008
y.create.l HWIO_SPMI_PIC_OWNER0_ACC_STATUS3_ADDR A:0x390000c
y.create.l HWIO_SPMI_PIC_OWNER1_ACC_STATUS0_ADDR A:0x3901000
y.create.l HWIO_SPMI_PIC_OWNER1_ACC_STATUS1_ADDR A:0x3901004
y.create.l HWIO_SPMI_PIC_OWNER1_ACC_STATUS2_ADDR A:0x3901008
y.create.l HWIO_SPMI_PIC_OWNER1_ACC_STATUS3_ADDR A:0x390100c
y.create.l HWIO_SPMI_PIC_OWNER2_ACC_STATUS0_ADDR A:0x3902000
y.create.l HWIO_SPMI_PIC_OWNER2_ACC_STATUS1_ADDR A:0x3902004
y.create.l HWIO_SPMI_PIC_OWNER2_ACC_STATUS2_ADDR A:0x3902008
y.create.l HWIO_SPMI_PIC_OWNER2_ACC_STATUS3_ADDR A:0x390200c
y.create.l HWIO_SPMI_PIC_OWNER3_ACC_STATUS0_ADDR A:0x3903000
y.create.l HWIO_SPMI_PIC_OWNER3_ACC_STATUS1_ADDR A:0x3903004
y.create.l HWIO_SPMI_PIC_OWNER3_ACC_STATUS2_ADDR A:0x3903008
y.create.l HWIO_SPMI_PIC_OWNER3_ACC_STATUS3_ADDR A:0x390300c
y.create.l HWIO_SPMI_PIC_OWNER4_ACC_STATUS0_ADDR A:0x3904000
y.create.l HWIO_SPMI_PIC_OWNER4_ACC_STATUS1_ADDR A:0x3904004
y.create.l HWIO_SPMI_PIC_OWNER4_ACC_STATUS2_ADDR A:0x3904008
y.create.l HWIO_SPMI_PIC_OWNER4_ACC_STATUS3_ADDR A:0x390400c
y.create.l HWIO_SPMI_PIC_OWNER5_ACC_STATUS0_ADDR A:0x3905000
y.create.l HWIO_SPMI_PIC_OWNER5_ACC_STATUS1_ADDR A:0x3905004
y.create.l HWIO_SPMI_PIC_OWNER5_ACC_STATUS2_ADDR A:0x3905008
y.create.l HWIO_SPMI_PIC_OWNER5_ACC_STATUS3_ADDR A:0x390500c
y.create.l HWIO_SPMI_PIC_ACC_ENABLE0_ADDR A:0x3800000
y.create.l HWIO_SPMI_PIC_ACC_ENABLE1_ADDR A:0x3801000
y.create.l HWIO_SPMI_PIC_ACC_ENABLE2_ADDR A:0x3802000
y.create.l HWIO_SPMI_PIC_ACC_ENABLE3_ADDR A:0x3803000
y.create.l HWIO_SPMI_PIC_ACC_ENABLE4_ADDR A:0x3804000
y.create.l HWIO_SPMI_PIC_ACC_ENABLE5_ADDR A:0x3805000
y.create.l HWIO_SPMI_PIC_ACC_ENABLE6_ADDR A:0x3806000
y.create.l HWIO_SPMI_PIC_ACC_ENABLE7_ADDR A:0x3807000
y.create.l HWIO_SPMI_PIC_ACC_ENABLE8_ADDR A:0x3808000
y.create.l HWIO_SPMI_PIC_ACC_ENABLE9_ADDR A:0x3809000
y.create.l HWIO_SPMI_PIC_IRQ_STATUS0_ADDR A:0x3800004
y.create.l HWIO_SPMI_PIC_IRQ_STATUS1_ADDR A:0x3801004
y.create.l HWIO_SPMI_PIC_IRQ_STATUS2_ADDR A:0x3802004
y.create.l HWIO_SPMI_PIC_IRQ_STATUS3_ADDR A:0x3803004
y.create.l HWIO_SPMI_PIC_IRQ_STATUS4_ADDR A:0x3804004
y.create.l HWIO_SPMI_PIC_IRQ_STATUS5_ADDR A:0x3805004
y.create.l HWIO_SPMI_PIC_IRQ_STATUS6_ADDR A:0x3806004
y.create.l HWIO_SPMI_PIC_IRQ_STATUS7_ADDR A:0x3807004
y.create.l HWIO_SPMI_PIC_IRQ_STATUS8_ADDR A:0x3808004
y.create.l HWIO_SPMI_PIC_IRQ_STATUS9_ADDR A:0x3809004
y.create.l HWIO_SPMI_PIC_IRQ_CLEAR0_ADDR A:0x3800008
y.create.l HWIO_SPMI_PIC_IRQ_CLEAR1_ADDR A:0x3801008
y.create.l HWIO_SPMI_PIC_IRQ_CLEAR2_ADDR A:0x3802008
y.create.l HWIO_SPMI_PIC_IRQ_CLEAR3_ADDR A:0x3803008
y.create.l HWIO_SPMI_PIC_IRQ_CLEAR4_ADDR A:0x3804008
y.create.l HWIO_SPMI_PIC_IRQ_CLEAR5_ADDR A:0x3805008
y.create.l HWIO_SPMI_PIC_IRQ_CLEAR6_ADDR A:0x3806008
y.create.l HWIO_SPMI_PIC_IRQ_CLEAR7_ADDR A:0x3807008
y.create.l HWIO_SPMI_PIC_IRQ_CLEAR8_ADDR A:0x3808008
y.create.l HWIO_SPMI_PIC_IRQ_CLEAR9_ADDR A:0x3809008
y.create.l HWIO_PMIC_ARB_XPU_SCR_ADDR A:0x200e000
y.create.l HWIO_PMIC_ARB_XPU_SWDR_ADDR A:0x200e004
y.create.l HWIO_PMIC_ARB_XPU_PRTN_RACR_SSHADOW_ADDR A:0x200e008
y.create.l HWIO_PMIC_ARB_XPU_PRTN_WACR_SSHADOW_ADDR A:0x200e00c
y.create.l HWIO_PMIC_ARB_XPU_PRTN_START_SSHADOW0_ADDR A:0x200e010
y.create.l HWIO_PMIC_ARB_XPU_PRTN_END_SSHADOW0_ADDR A:0x200e018
y.create.l HWIO_PMIC_ARB_XPU_SEAR0_ADDR A:0x200e040
y.create.l HWIO_PMIC_ARB_XPU_SESR_ADDR A:0x200e048
y.create.l HWIO_PMIC_ARB_XPU_SESRRESTORE_ADDR A:0x200e04c
y.create.l HWIO_PMIC_ARB_XPU_SESYNR0_ADDR A:0x200e050
y.create.l HWIO_PMIC_ARB_XPU_SESYNR1_ADDR A:0x200e054
y.create.l HWIO_PMIC_ARB_XPU_SESYNR2_ADDR A:0x200e058
y.create.l HWIO_PMIC_ARB_XPU_MCR_ADDR A:0x200e100
y.create.l HWIO_PMIC_ARB_XPU_MEAR0_ADDR A:0x200e140
y.create.l HWIO_PMIC_ARB_XPU_MESR_ADDR A:0x200e148
y.create.l HWIO_PMIC_ARB_XPU_MESRRESTORE_ADDR A:0x200e14c
y.create.l HWIO_PMIC_ARB_XPU_MESYNR0_ADDR A:0x200e150
y.create.l HWIO_PMIC_ARB_XPU_MESYNR1_ADDR A:0x200e154
y.create.l HWIO_PMIC_ARB_XPU_MESYNR2_ADDR A:0x200e158
y.create.l HWIO_PMIC_ARB_XPU_CR_ADDR A:0x200e080
y.create.l HWIO_PMIC_ARB_XPU_PRTN_RACR_SHADOW_ADDR A:0x200e088
y.create.l HWIO_PMIC_ARB_XPU_PRTN_WACR_SHADOW_ADDR A:0x200e08c
y.create.l HWIO_PMIC_ARB_XPU_PRTN_START_SHADOW0_ADDR A:0x200e090
y.create.l HWIO_PMIC_ARB_XPU_PRTN_END_SHADOW0_ADDR A:0x200e098
y.create.l HWIO_PMIC_ARB_XPU_RPU_ACR0_ADDR A:0x200e0a0
y.create.l HWIO_PMIC_ARB_XPU_EAR0_ADDR A:0x200e0c0
y.create.l HWIO_PMIC_ARB_XPU_ESR_ADDR A:0x200e0c8
y.create.l HWIO_PMIC_ARB_XPU_ESRRESTORE_ADDR A:0x200e0cc
y.create.l HWIO_PMIC_ARB_XPU_ESYNR0_ADDR A:0x200e0d0
y.create.l HWIO_PMIC_ARB_XPU_ESYNR1_ADDR A:0x200e0d4
y.create.l HWIO_PMIC_ARB_XPU_ESYNR2_ADDR A:0x200e0d8
y.create.l HWIO_PMIC_ARB_XPU_UMR_RACR_ADDR A:0x200e0e0
y.create.l HWIO_PMIC_ARB_XPU_UMR_WACR_ADDR A:0x200e0e4
y.create.l HWIO_PMIC_ARB_XPU_UMR_CNTL_ADDR A:0x200e0f0
y.create.l HWIO_PMIC_ARB_XPU_IDR0_ADDR A:0x200e074
y.create.l HWIO_PMIC_ARB_XPU_IDR1_ADDR A:0x200e078
y.create.l HWIO_PMIC_ARB_XPU_REV_ADDR A:0x200e07c
y.create.l HWIO_PMIC_ARB_XPU_PRT0_RACR0_ADDR A:0x200e200
y.create.l HWIO_PMIC_ARB_XPU_PRT1_RACR0_ADDR A:0x200e280
y.create.l HWIO_PMIC_ARB_XPU_PRT2_RACR0_ADDR A:0x200e300
y.create.l HWIO_PMIC_ARB_XPU_PRT3_RACR0_ADDR A:0x200e380
y.create.l HWIO_PMIC_ARB_XPU_PRT4_RACR0_ADDR A:0x200e400
y.create.l HWIO_PMIC_ARB_XPU_PRT5_RACR0_ADDR A:0x200e480
y.create.l HWIO_PMIC_ARB_XPU_PRT6_RACR0_ADDR A:0x200e500
y.create.l HWIO_PMIC_ARB_XPU_PRT7_RACR0_ADDR A:0x200e580
y.create.l HWIO_PMIC_ARB_XPU_PRT8_RACR0_ADDR A:0x200e600
y.create.l HWIO_PMIC_ARB_XPU_PRT9_RACR0_ADDR A:0x200e680
y.create.l HWIO_PMIC_ARB_XPU_PRT0_WACR0_ADDR A:0x200e220
y.create.l HWIO_PMIC_ARB_XPU_PRT1_WACR0_ADDR A:0x200e2a0
y.create.l HWIO_PMIC_ARB_XPU_PRT2_WACR0_ADDR A:0x200e320
y.create.l HWIO_PMIC_ARB_XPU_PRT3_WACR0_ADDR A:0x200e3a0
y.create.l HWIO_PMIC_ARB_XPU_PRT4_WACR0_ADDR A:0x200e420
y.create.l HWIO_PMIC_ARB_XPU_PRT5_WACR0_ADDR A:0x200e4a0
y.create.l HWIO_PMIC_ARB_XPU_PRT6_WACR0_ADDR A:0x200e520
y.create.l HWIO_PMIC_ARB_XPU_PRT7_WACR0_ADDR A:0x200e5a0
y.create.l HWIO_PMIC_ARB_XPU_PRT8_WACR0_ADDR A:0x200e620
y.create.l HWIO_PMIC_ARB_XPU_PRT9_WACR0_ADDR A:0x200e6a0
y.create.l HWIO_PMIC_ARB_XPU_PRT0_START0_ADDR A:0x200e240
y.create.l HWIO_PMIC_ARB_XPU_PRT1_START0_ADDR A:0x200e2c0
y.create.l HWIO_PMIC_ARB_XPU_PRT2_START0_ADDR A:0x200e340
y.create.l HWIO_PMIC_ARB_XPU_PRT3_START0_ADDR A:0x200e3c0
y.create.l HWIO_PMIC_ARB_XPU_PRT4_START0_ADDR A:0x200e440
y.create.l HWIO_PMIC_ARB_XPU_PRT5_START0_ADDR A:0x200e4c0
y.create.l HWIO_PMIC_ARB_XPU_PRT6_START0_ADDR A:0x200e540
y.create.l HWIO_PMIC_ARB_XPU_PRT7_START0_ADDR A:0x200e5c0
y.create.l HWIO_PMIC_ARB_XPU_PRT8_START0_ADDR A:0x200e640
y.create.l HWIO_PMIC_ARB_XPU_PRT9_START0_ADDR A:0x200e6c0
y.create.l HWIO_PMIC_ARB_XPU_PRT0_END0_ADDR A:0x200e248
y.create.l HWIO_PMIC_ARB_XPU_PRT1_END0_ADDR A:0x200e2c8
y.create.l HWIO_PMIC_ARB_XPU_PRT2_END0_ADDR A:0x200e348
y.create.l HWIO_PMIC_ARB_XPU_PRT3_END0_ADDR A:0x200e3c8
y.create.l HWIO_PMIC_ARB_XPU_PRT4_END0_ADDR A:0x200e448
y.create.l HWIO_PMIC_ARB_XPU_PRT5_END0_ADDR A:0x200e4c8
y.create.l HWIO_PMIC_ARB_XPU_PRT6_END0_ADDR A:0x200e548
y.create.l HWIO_PMIC_ARB_XPU_PRT7_END0_ADDR A:0x200e5c8
y.create.l HWIO_PMIC_ARB_XPU_PRT8_END0_ADDR A:0x200e648
y.create.l HWIO_PMIC_ARB_XPU_PRT9_END0_ADDR A:0x200e6c8
y.create.l HWIO_PMIC_ARB_XPU_PRT0_SCR_ADDR A:0x200e250
y.create.l HWIO_PMIC_ARB_XPU_PRT1_SCR_ADDR A:0x200e2d0
y.create.l HWIO_PMIC_ARB_XPU_PRT2_SCR_ADDR A:0x200e350
y.create.l HWIO_PMIC_ARB_XPU_PRT3_SCR_ADDR A:0x200e3d0
y.create.l HWIO_PMIC_ARB_XPU_PRT4_SCR_ADDR A:0x200e450
y.create.l HWIO_PMIC_ARB_XPU_PRT5_SCR_ADDR A:0x200e4d0
y.create.l HWIO_PMIC_ARB_XPU_PRT6_SCR_ADDR A:0x200e550
y.create.l HWIO_PMIC_ARB_XPU_PRT7_SCR_ADDR A:0x200e5d0
y.create.l HWIO_PMIC_ARB_XPU_PRT8_SCR_ADDR A:0x200e650
y.create.l HWIO_PMIC_ARB_XPU_PRT9_SCR_ADDR A:0x200e6d0
y.create.l HWIO_PMIC_ARB_XPU_PRT0_MCR_ADDR A:0x200e254
y.create.l HWIO_PMIC_ARB_XPU_PRT1_MCR_ADDR A:0x200e2d4
y.create.l HWIO_PMIC_ARB_XPU_PRT2_MCR_ADDR A:0x200e354
y.create.l HWIO_PMIC_ARB_XPU_PRT3_MCR_ADDR A:0x200e3d4
y.create.l HWIO_PMIC_ARB_XPU_PRT4_MCR_ADDR A:0x200e454
y.create.l HWIO_PMIC_ARB_XPU_PRT5_MCR_ADDR A:0x200e4d4
y.create.l HWIO_PMIC_ARB_XPU_PRT6_MCR_ADDR A:0x200e554
y.create.l HWIO_PMIC_ARB_XPU_PRT7_MCR_ADDR A:0x200e5d4
y.create.l HWIO_PMIC_ARB_XPU_PRT8_MCR_ADDR A:0x200e654
y.create.l HWIO_PMIC_ARB_XPU_PRT9_MCR_ADDR A:0x200e6d4
y.create.l HWIO_PMIC_ARB_XPU_PRT0_CNTL0_ADDR A:0x200e258
y.create.l HWIO_PMIC_ARB_XPU_PRT1_CNTL0_ADDR A:0x200e2d8
y.create.l HWIO_PMIC_ARB_XPU_PRT2_CNTL0_ADDR A:0x200e358
y.create.l HWIO_PMIC_ARB_XPU_PRT3_CNTL0_ADDR A:0x200e3d8
y.create.l HWIO_PMIC_ARB_XPU_PRT4_CNTL0_ADDR A:0x200e458
y.create.l HWIO_PMIC_ARB_XPU_PRT5_CNTL0_ADDR A:0x200e4d8
y.create.l HWIO_PMIC_ARB_XPU_PRT6_CNTL0_ADDR A:0x200e558
y.create.l HWIO_PMIC_ARB_XPU_PRT7_CNTL0_ADDR A:0x200e5d8
y.create.l HWIO_PMIC_ARB_XPU_PRT8_CNTL0_ADDR A:0x200e658
y.create.l HWIO_PMIC_ARB_XPU_PRT9_CNTL0_ADDR A:0x200e6d8
y.create.l HWIO_PMIC_ARB_XPU_PRT0_CNTL1_ADDR A:0x200e25c
y.create.l HWIO_PMIC_ARB_XPU_PRT1_CNTL1_ADDR A:0x200e2dc
y.create.l HWIO_PMIC_ARB_XPU_PRT2_CNTL1_ADDR A:0x200e35c
y.create.l HWIO_PMIC_ARB_XPU_PRT3_CNTL1_ADDR A:0x200e3dc
y.create.l HWIO_PMIC_ARB_XPU_PRT4_CNTL1_ADDR A:0x200e45c
y.create.l HWIO_PMIC_ARB_XPU_PRT5_CNTL1_ADDR A:0x200e4dc
y.create.l HWIO_PMIC_ARB_XPU_PRT6_CNTL1_ADDR A:0x200e55c
y.create.l HWIO_PMIC_ARB_XPU_PRT7_CNTL1_ADDR A:0x200e5dc
y.create.l HWIO_PMIC_ARB_XPU_PRT8_CNTL1_ADDR A:0x200e65c
y.create.l HWIO_PMIC_ARB_XPU_PRT9_CNTL1_ADDR A:0x200e6dc
y.create.l HWIO_PMIC_ARB_HW_VERSION_ADDR A:0x200f000
y.create.l HWIO_PMIC_ARB_MISC_CONFIG_ADDR A:0x200f004
y.create.l HWIO_PMIC_ARB_PVC_INTF_CTL_ADDR A:0x200f008
y.create.l HWIO_PMIC_ARB_PVC_INTF_STATUS_ADDR A:0x200f00c
y.create.l HWIO_PMIC_ARB_PRIORITIES0_ADDR A:0x200f100
y.create.l HWIO_PMIC_ARB_PRIORITIES1_ADDR A:0x200f104
y.create.l HWIO_PMIC_ARB_PRIORITIES2_ADDR A:0x200f108
y.create.l HWIO_PMIC_ARB_PRIORITIES3_ADDR A:0x200f10c
y.create.l HWIO_PMIC_ARB_PRIORITIES4_ADDR A:0x200f110
y.create.l HWIO_PMIC_ARB_PRIORITIES5_ADDR A:0x200f114
y.create.l HWIO_PMIC_ARB_PRIORITIES6_ADDR A:0x200f118
y.create.l HWIO_PMIC_ARB_PVC_PORT0_CTL_ADDR A:0x200f200
y.create.l HWIO_PMIC_ARB_PVC_PORT1_CTL_ADDR A:0x200f204
y.create.l HWIO_PMIC_ARB_PVC_PORT2_CTL_ADDR A:0x200f208
y.create.l HWIO_PMIC_ARB_PVC_PORT3_CTL_ADDR A:0x200f20c
y.create.l HWIO_PMIC_ARB_PVC_PORT4_CTL_ADDR A:0x200f210
y.create.l HWIO_PMIC_ARB_PVC_PORT5_CTL_ADDR A:0x200f214
y.create.l HWIO_PMIC_ARB_PVC_PORT0_STATUS_ADDR A:0x200f280
y.create.l HWIO_PMIC_ARB_PVC_PORT1_STATUS_ADDR A:0x200f284
y.create.l HWIO_PMIC_ARB_PVC_PORT2_STATUS_ADDR A:0x200f288
y.create.l HWIO_PMIC_ARB_PVC_PORT3_STATUS_ADDR A:0x200f28c
y.create.l HWIO_PMIC_ARB_PVC_PORT4_STATUS_ADDR A:0x200f290
y.create.l HWIO_PMIC_ARB_PVC_PORT5_STATUS_ADDR A:0x200f294
y.create.l HWIO_PMIC_ARB_PVC0_ADDR0_ADDR A:0x200f400
y.create.l HWIO_PMIC_ARB_PVC0_ADDR1_ADDR A:0x200f404
y.create.l HWIO_PMIC_ARB_PVC0_ADDR2_ADDR A:0x200f408
y.create.l HWIO_PMIC_ARB_PVC0_ADDR3_ADDR A:0x200f40c
y.create.l HWIO_PMIC_ARB_PVC1_ADDR0_ADDR A:0x200f420
y.create.l HWIO_PMIC_ARB_PVC1_ADDR1_ADDR A:0x200f424
y.create.l HWIO_PMIC_ARB_PVC1_ADDR2_ADDR A:0x200f428
y.create.l HWIO_PMIC_ARB_PVC1_ADDR3_ADDR A:0x200f42c
y.create.l HWIO_PMIC_ARB_PVC2_ADDR0_ADDR A:0x200f440
y.create.l HWIO_PMIC_ARB_PVC2_ADDR1_ADDR A:0x200f444
y.create.l HWIO_PMIC_ARB_PVC2_ADDR2_ADDR A:0x200f448
y.create.l HWIO_PMIC_ARB_PVC2_ADDR3_ADDR A:0x200f44c
y.create.l HWIO_PMIC_ARB_PVC3_ADDR0_ADDR A:0x200f460
y.create.l HWIO_PMIC_ARB_PVC3_ADDR1_ADDR A:0x200f464
y.create.l HWIO_PMIC_ARB_PVC3_ADDR2_ADDR A:0x200f468
y.create.l HWIO_PMIC_ARB_PVC3_ADDR3_ADDR A:0x200f46c
y.create.l HWIO_PMIC_ARB_PVC4_ADDR0_ADDR A:0x200f480
y.create.l HWIO_PMIC_ARB_PVC4_ADDR1_ADDR A:0x200f484
y.create.l HWIO_PMIC_ARB_PVC4_ADDR2_ADDR A:0x200f488
y.create.l HWIO_PMIC_ARB_PVC4_ADDR3_ADDR A:0x200f48c
y.create.l HWIO_PMIC_ARB_PVC5_ADDR0_ADDR A:0x200f4a0
y.create.l HWIO_PMIC_ARB_PVC5_ADDR1_ADDR A:0x200f4a4
y.create.l HWIO_PMIC_ARB_PVC5_ADDR2_ADDR A:0x200f4a8
y.create.l HWIO_PMIC_ARB_PVC5_ADDR3_ADDR A:0x200f4ac
y.create.l HWIO_PMIC_ARB_REG_CHNL0_ADDR A:0x200f800
y.create.l HWIO_PMIC_ARB_REG_CHNL1_ADDR A:0x200f804
y.create.l HWIO_PMIC_ARB_REG_CHNL2_ADDR A:0x200f808
y.create.l HWIO_PMIC_ARB_REG_CHNL3_ADDR A:0x200f80c
y.create.l HWIO_PMIC_ARB_REG_CHNL4_ADDR A:0x200f810
y.create.l HWIO_PMIC_ARB_REG_CHNL5_ADDR A:0x200f814
y.create.l HWIO_PMIC_ARB_REG_CHNL6_ADDR A:0x200f818
y.create.l HWIO_PMIC_ARB_REG_CHNL7_ADDR A:0x200f81c
y.create.l HWIO_PMIC_ARB_REG_CHNL8_ADDR A:0x200f820
y.create.l HWIO_PMIC_ARB_REG_CHNL9_ADDR A:0x200f824
y.create.l HWIO_PMIC_ARB0_CHNL0_CMD_ADDR A:0x2400000
y.create.l HWIO_PMIC_ARB0_CHNL1_CMD_ADDR A:0x2408000
y.create.l HWIO_PMIC_ARB0_CHNL2_CMD_ADDR A:0x2410000
y.create.l HWIO_PMIC_ARB0_CHNL3_CMD_ADDR A:0x2418000
y.create.l HWIO_PMIC_ARB1_CHNL0_CMD_ADDR A:0x2401000
y.create.l HWIO_PMIC_ARB1_CHNL1_CMD_ADDR A:0x2409000
y.create.l HWIO_PMIC_ARB1_CHNL2_CMD_ADDR A:0x2411000
y.create.l HWIO_PMIC_ARB1_CHNL3_CMD_ADDR A:0x2419000
y.create.l HWIO_PMIC_ARB2_CHNL0_CMD_ADDR A:0x2402000
y.create.l HWIO_PMIC_ARB2_CHNL1_CMD_ADDR A:0x240a000
y.create.l HWIO_PMIC_ARB2_CHNL2_CMD_ADDR A:0x2412000
y.create.l HWIO_PMIC_ARB2_CHNL3_CMD_ADDR A:0x241a000
y.create.l HWIO_PMIC_ARB3_CHNL0_CMD_ADDR A:0x2403000
y.create.l HWIO_PMIC_ARB3_CHNL1_CMD_ADDR A:0x240b000
y.create.l HWIO_PMIC_ARB3_CHNL2_CMD_ADDR A:0x2413000
y.create.l HWIO_PMIC_ARB3_CHNL3_CMD_ADDR A:0x241b000
y.create.l HWIO_PMIC_ARB4_CHNL0_CMD_ADDR A:0x2404000
y.create.l HWIO_PMIC_ARB4_CHNL1_CMD_ADDR A:0x240c000
y.create.l HWIO_PMIC_ARB4_CHNL2_CMD_ADDR A:0x2414000
y.create.l HWIO_PMIC_ARB4_CHNL3_CMD_ADDR A:0x241c000
y.create.l HWIO_PMIC_ARB5_CHNL0_CMD_ADDR A:0x2405000
y.create.l HWIO_PMIC_ARB5_CHNL1_CMD_ADDR A:0x240d000
y.create.l HWIO_PMIC_ARB5_CHNL2_CMD_ADDR A:0x2415000
y.create.l HWIO_PMIC_ARB5_CHNL3_CMD_ADDR A:0x241d000
y.create.l HWIO_PMIC_ARB0_CHNL0_CONFIG_ADDR A:0x2400004
y.create.l HWIO_PMIC_ARB0_CHNL1_CONFIG_ADDR A:0x2408004
y.create.l HWIO_PMIC_ARB0_CHNL2_CONFIG_ADDR A:0x2410004
y.create.l HWIO_PMIC_ARB0_CHNL3_CONFIG_ADDR A:0x2418004
y.create.l HWIO_PMIC_ARB1_CHNL0_CONFIG_ADDR A:0x2401004
y.create.l HWIO_PMIC_ARB1_CHNL1_CONFIG_ADDR A:0x2409004
y.create.l HWIO_PMIC_ARB1_CHNL2_CONFIG_ADDR A:0x2411004
y.create.l HWIO_PMIC_ARB1_CHNL3_CONFIG_ADDR A:0x2419004
y.create.l HWIO_PMIC_ARB2_CHNL0_CONFIG_ADDR A:0x2402004
y.create.l HWIO_PMIC_ARB2_CHNL1_CONFIG_ADDR A:0x240a004
y.create.l HWIO_PMIC_ARB2_CHNL2_CONFIG_ADDR A:0x2412004
y.create.l HWIO_PMIC_ARB2_CHNL3_CONFIG_ADDR A:0x241a004
y.create.l HWIO_PMIC_ARB3_CHNL0_CONFIG_ADDR A:0x2403004
y.create.l HWIO_PMIC_ARB3_CHNL1_CONFIG_ADDR A:0x240b004
y.create.l HWIO_PMIC_ARB3_CHNL2_CONFIG_ADDR A:0x2413004
y.create.l HWIO_PMIC_ARB3_CHNL3_CONFIG_ADDR A:0x241b004
y.create.l HWIO_PMIC_ARB4_CHNL0_CONFIG_ADDR A:0x2404004
y.create.l HWIO_PMIC_ARB4_CHNL1_CONFIG_ADDR A:0x240c004
y.create.l HWIO_PMIC_ARB4_CHNL2_CONFIG_ADDR A:0x2414004
y.create.l HWIO_PMIC_ARB4_CHNL3_CONFIG_ADDR A:0x241c004
y.create.l HWIO_PMIC_ARB5_CHNL0_CONFIG_ADDR A:0x2405004
y.create.l HWIO_PMIC_ARB5_CHNL1_CONFIG_ADDR A:0x240d004
y.create.l HWIO_PMIC_ARB5_CHNL2_CONFIG_ADDR A:0x2415004
y.create.l HWIO_PMIC_ARB5_CHNL3_CONFIG_ADDR A:0x241d004
y.create.l HWIO_PMIC_ARB0_CHNL0_STATUS_ADDR A:0x2400008
y.create.l HWIO_PMIC_ARB0_CHNL1_STATUS_ADDR A:0x2408008
y.create.l HWIO_PMIC_ARB0_CHNL2_STATUS_ADDR A:0x2410008
y.create.l HWIO_PMIC_ARB0_CHNL3_STATUS_ADDR A:0x2418008
y.create.l HWIO_PMIC_ARB1_CHNL0_STATUS_ADDR A:0x2401008
y.create.l HWIO_PMIC_ARB1_CHNL1_STATUS_ADDR A:0x2409008
y.create.l HWIO_PMIC_ARB1_CHNL2_STATUS_ADDR A:0x2411008
y.create.l HWIO_PMIC_ARB1_CHNL3_STATUS_ADDR A:0x2419008
y.create.l HWIO_PMIC_ARB2_CHNL0_STATUS_ADDR A:0x2402008
y.create.l HWIO_PMIC_ARB2_CHNL1_STATUS_ADDR A:0x240a008
y.create.l HWIO_PMIC_ARB2_CHNL2_STATUS_ADDR A:0x2412008
y.create.l HWIO_PMIC_ARB2_CHNL3_STATUS_ADDR A:0x241a008
y.create.l HWIO_PMIC_ARB3_CHNL0_STATUS_ADDR A:0x2403008
y.create.l HWIO_PMIC_ARB3_CHNL1_STATUS_ADDR A:0x240b008
y.create.l HWIO_PMIC_ARB3_CHNL2_STATUS_ADDR A:0x2413008
y.create.l HWIO_PMIC_ARB3_CHNL3_STATUS_ADDR A:0x241b008
y.create.l HWIO_PMIC_ARB4_CHNL0_STATUS_ADDR A:0x2404008
y.create.l HWIO_PMIC_ARB4_CHNL1_STATUS_ADDR A:0x240c008
y.create.l HWIO_PMIC_ARB4_CHNL2_STATUS_ADDR A:0x2414008
y.create.l HWIO_PMIC_ARB4_CHNL3_STATUS_ADDR A:0x241c008
y.create.l HWIO_PMIC_ARB5_CHNL0_STATUS_ADDR A:0x2405008
y.create.l HWIO_PMIC_ARB5_CHNL1_STATUS_ADDR A:0x240d008
y.create.l HWIO_PMIC_ARB5_CHNL2_STATUS_ADDR A:0x2415008
y.create.l HWIO_PMIC_ARB5_CHNL3_STATUS_ADDR A:0x241d008
y.create.l HWIO_PMIC_ARB0_CHNL0_WDATA0_ADDR A:0x2400010
y.create.l HWIO_PMIC_ARB0_CHNL1_WDATA0_ADDR A:0x2408010
y.create.l HWIO_PMIC_ARB0_CHNL2_WDATA0_ADDR A:0x2410010
y.create.l HWIO_PMIC_ARB0_CHNL3_WDATA0_ADDR A:0x2418010
y.create.l HWIO_PMIC_ARB1_CHNL0_WDATA0_ADDR A:0x2401010
y.create.l HWIO_PMIC_ARB1_CHNL1_WDATA0_ADDR A:0x2409010
y.create.l HWIO_PMIC_ARB1_CHNL2_WDATA0_ADDR A:0x2411010
y.create.l HWIO_PMIC_ARB1_CHNL3_WDATA0_ADDR A:0x2419010
y.create.l HWIO_PMIC_ARB2_CHNL0_WDATA0_ADDR A:0x2402010
y.create.l HWIO_PMIC_ARB2_CHNL1_WDATA0_ADDR A:0x240a010
y.create.l HWIO_PMIC_ARB2_CHNL2_WDATA0_ADDR A:0x2412010
y.create.l HWIO_PMIC_ARB2_CHNL3_WDATA0_ADDR A:0x241a010
y.create.l HWIO_PMIC_ARB3_CHNL0_WDATA0_ADDR A:0x2403010
y.create.l HWIO_PMIC_ARB3_CHNL1_WDATA0_ADDR A:0x240b010
y.create.l HWIO_PMIC_ARB3_CHNL2_WDATA0_ADDR A:0x2413010
y.create.l HWIO_PMIC_ARB3_CHNL3_WDATA0_ADDR A:0x241b010
y.create.l HWIO_PMIC_ARB4_CHNL0_WDATA0_ADDR A:0x2404010
y.create.l HWIO_PMIC_ARB4_CHNL1_WDATA0_ADDR A:0x240c010
y.create.l HWIO_PMIC_ARB4_CHNL2_WDATA0_ADDR A:0x2414010
y.create.l HWIO_PMIC_ARB4_CHNL3_WDATA0_ADDR A:0x241c010
y.create.l HWIO_PMIC_ARB5_CHNL0_WDATA0_ADDR A:0x2405010
y.create.l HWIO_PMIC_ARB5_CHNL1_WDATA0_ADDR A:0x240d010
y.create.l HWIO_PMIC_ARB5_CHNL2_WDATA0_ADDR A:0x2415010
y.create.l HWIO_PMIC_ARB5_CHNL3_WDATA0_ADDR A:0x241d010
y.create.l HWIO_PMIC_ARB0_CHNL0_WDATA1_ADDR A:0x2400014
y.create.l HWIO_PMIC_ARB0_CHNL1_WDATA1_ADDR A:0x2408014
y.create.l HWIO_PMIC_ARB0_CHNL2_WDATA1_ADDR A:0x2410014
y.create.l HWIO_PMIC_ARB0_CHNL3_WDATA1_ADDR A:0x2418014
y.create.l HWIO_PMIC_ARB1_CHNL0_WDATA1_ADDR A:0x2401014
y.create.l HWIO_PMIC_ARB1_CHNL1_WDATA1_ADDR A:0x2409014
y.create.l HWIO_PMIC_ARB1_CHNL2_WDATA1_ADDR A:0x2411014
y.create.l HWIO_PMIC_ARB1_CHNL3_WDATA1_ADDR A:0x2419014
y.create.l HWIO_PMIC_ARB2_CHNL0_WDATA1_ADDR A:0x2402014
y.create.l HWIO_PMIC_ARB2_CHNL1_WDATA1_ADDR A:0x240a014
y.create.l HWIO_PMIC_ARB2_CHNL2_WDATA1_ADDR A:0x2412014
y.create.l HWIO_PMIC_ARB2_CHNL3_WDATA1_ADDR A:0x241a014
y.create.l HWIO_PMIC_ARB3_CHNL0_WDATA1_ADDR A:0x2403014
y.create.l HWIO_PMIC_ARB3_CHNL1_WDATA1_ADDR A:0x240b014
y.create.l HWIO_PMIC_ARB3_CHNL2_WDATA1_ADDR A:0x2413014
y.create.l HWIO_PMIC_ARB3_CHNL3_WDATA1_ADDR A:0x241b014
y.create.l HWIO_PMIC_ARB4_CHNL0_WDATA1_ADDR A:0x2404014
y.create.l HWIO_PMIC_ARB4_CHNL1_WDATA1_ADDR A:0x240c014
y.create.l HWIO_PMIC_ARB4_CHNL2_WDATA1_ADDR A:0x2414014
y.create.l HWIO_PMIC_ARB4_CHNL3_WDATA1_ADDR A:0x241c014
y.create.l HWIO_PMIC_ARB5_CHNL0_WDATA1_ADDR A:0x2405014
y.create.l HWIO_PMIC_ARB5_CHNL1_WDATA1_ADDR A:0x240d014
y.create.l HWIO_PMIC_ARB5_CHNL2_WDATA1_ADDR A:0x2415014
y.create.l HWIO_PMIC_ARB5_CHNL3_WDATA1_ADDR A:0x241d014
y.create.l HWIO_PMIC_ARB0_CHNL0_RDATA0_ADDR A:0x2400018
y.create.l HWIO_PMIC_ARB0_CHNL1_RDATA0_ADDR A:0x2408018
y.create.l HWIO_PMIC_ARB0_CHNL2_RDATA0_ADDR A:0x2410018
y.create.l HWIO_PMIC_ARB0_CHNL3_RDATA0_ADDR A:0x2418018
y.create.l HWIO_PMIC_ARB1_CHNL0_RDATA0_ADDR A:0x2401018
y.create.l HWIO_PMIC_ARB1_CHNL1_RDATA0_ADDR A:0x2409018
y.create.l HWIO_PMIC_ARB1_CHNL2_RDATA0_ADDR A:0x2411018
y.create.l HWIO_PMIC_ARB1_CHNL3_RDATA0_ADDR A:0x2419018
y.create.l HWIO_PMIC_ARB2_CHNL0_RDATA0_ADDR A:0x2402018
y.create.l HWIO_PMIC_ARB2_CHNL1_RDATA0_ADDR A:0x240a018
y.create.l HWIO_PMIC_ARB2_CHNL2_RDATA0_ADDR A:0x2412018
y.create.l HWIO_PMIC_ARB2_CHNL3_RDATA0_ADDR A:0x241a018
y.create.l HWIO_PMIC_ARB3_CHNL0_RDATA0_ADDR A:0x2403018
y.create.l HWIO_PMIC_ARB3_CHNL1_RDATA0_ADDR A:0x240b018
y.create.l HWIO_PMIC_ARB3_CHNL2_RDATA0_ADDR A:0x2413018
y.create.l HWIO_PMIC_ARB3_CHNL3_RDATA0_ADDR A:0x241b018
y.create.l HWIO_PMIC_ARB4_CHNL0_RDATA0_ADDR A:0x2404018
y.create.l HWIO_PMIC_ARB4_CHNL1_RDATA0_ADDR A:0x240c018
y.create.l HWIO_PMIC_ARB4_CHNL2_RDATA0_ADDR A:0x2414018
y.create.l HWIO_PMIC_ARB4_CHNL3_RDATA0_ADDR A:0x241c018
y.create.l HWIO_PMIC_ARB5_CHNL0_RDATA0_ADDR A:0x2405018
y.create.l HWIO_PMIC_ARB5_CHNL1_RDATA0_ADDR A:0x240d018
y.create.l HWIO_PMIC_ARB5_CHNL2_RDATA0_ADDR A:0x2415018
y.create.l HWIO_PMIC_ARB5_CHNL3_RDATA0_ADDR A:0x241d018
y.create.l HWIO_PMIC_ARB0_CHNL0_RDATA1_ADDR A:0x240001c
y.create.l HWIO_PMIC_ARB0_CHNL1_RDATA1_ADDR A:0x240801c
y.create.l HWIO_PMIC_ARB0_CHNL2_RDATA1_ADDR A:0x241001c
y.create.l HWIO_PMIC_ARB0_CHNL3_RDATA1_ADDR A:0x241801c
y.create.l HWIO_PMIC_ARB1_CHNL0_RDATA1_ADDR A:0x240101c
y.create.l HWIO_PMIC_ARB1_CHNL1_RDATA1_ADDR A:0x240901c
y.create.l HWIO_PMIC_ARB1_CHNL2_RDATA1_ADDR A:0x241101c
y.create.l HWIO_PMIC_ARB1_CHNL3_RDATA1_ADDR A:0x241901c
y.create.l HWIO_PMIC_ARB2_CHNL0_RDATA1_ADDR A:0x240201c
y.create.l HWIO_PMIC_ARB2_CHNL1_RDATA1_ADDR A:0x240a01c
y.create.l HWIO_PMIC_ARB2_CHNL2_RDATA1_ADDR A:0x241201c
y.create.l HWIO_PMIC_ARB2_CHNL3_RDATA1_ADDR A:0x241a01c
y.create.l HWIO_PMIC_ARB3_CHNL0_RDATA1_ADDR A:0x240301c
y.create.l HWIO_PMIC_ARB3_CHNL1_RDATA1_ADDR A:0x240b01c
y.create.l HWIO_PMIC_ARB3_CHNL2_RDATA1_ADDR A:0x241301c
y.create.l HWIO_PMIC_ARB3_CHNL3_RDATA1_ADDR A:0x241b01c
y.create.l HWIO_PMIC_ARB4_CHNL0_RDATA1_ADDR A:0x240401c
y.create.l HWIO_PMIC_ARB4_CHNL1_RDATA1_ADDR A:0x240c01c
y.create.l HWIO_PMIC_ARB4_CHNL2_RDATA1_ADDR A:0x241401c
y.create.l HWIO_PMIC_ARB4_CHNL3_RDATA1_ADDR A:0x241c01c
y.create.l HWIO_PMIC_ARB5_CHNL0_RDATA1_ADDR A:0x240501c
y.create.l HWIO_PMIC_ARB5_CHNL1_RDATA1_ADDR A:0x240d01c
y.create.l HWIO_PMIC_ARB5_CHNL2_RDATA1_ADDR A:0x241501c
y.create.l HWIO_PMIC_ARB5_CHNL3_RDATA1_ADDR A:0x241d01c
y.create.l HWIO_PMIC_ARB0_CHNL0_RDATA2_ADDR A:0x2400020
y.create.l HWIO_PMIC_ARB0_CHNL1_RDATA2_ADDR A:0x2408020
y.create.l HWIO_PMIC_ARB0_CHNL2_RDATA2_ADDR A:0x2410020
y.create.l HWIO_PMIC_ARB0_CHNL3_RDATA2_ADDR A:0x2418020
y.create.l HWIO_PMIC_ARB1_CHNL0_RDATA2_ADDR A:0x2401020
y.create.l HWIO_PMIC_ARB1_CHNL1_RDATA2_ADDR A:0x2409020
y.create.l HWIO_PMIC_ARB1_CHNL2_RDATA2_ADDR A:0x2411020
y.create.l HWIO_PMIC_ARB1_CHNL3_RDATA2_ADDR A:0x2419020
y.create.l HWIO_PMIC_ARB2_CHNL0_RDATA2_ADDR A:0x2402020
y.create.l HWIO_PMIC_ARB2_CHNL1_RDATA2_ADDR A:0x240a020
y.create.l HWIO_PMIC_ARB2_CHNL2_RDATA2_ADDR A:0x2412020
y.create.l HWIO_PMIC_ARB2_CHNL3_RDATA2_ADDR A:0x241a020
y.create.l HWIO_PMIC_ARB3_CHNL0_RDATA2_ADDR A:0x2403020
y.create.l HWIO_PMIC_ARB3_CHNL1_RDATA2_ADDR A:0x240b020
y.create.l HWIO_PMIC_ARB3_CHNL2_RDATA2_ADDR A:0x2413020
y.create.l HWIO_PMIC_ARB3_CHNL3_RDATA2_ADDR A:0x241b020
y.create.l HWIO_PMIC_ARB4_CHNL0_RDATA2_ADDR A:0x2404020
y.create.l HWIO_PMIC_ARB4_CHNL1_RDATA2_ADDR A:0x240c020
y.create.l HWIO_PMIC_ARB4_CHNL2_RDATA2_ADDR A:0x2414020
y.create.l HWIO_PMIC_ARB4_CHNL3_RDATA2_ADDR A:0x241c020
y.create.l HWIO_PMIC_ARB5_CHNL0_RDATA2_ADDR A:0x2405020
y.create.l HWIO_PMIC_ARB5_CHNL1_RDATA2_ADDR A:0x240d020
y.create.l HWIO_PMIC_ARB5_CHNL2_RDATA2_ADDR A:0x2415020
y.create.l HWIO_PMIC_ARB5_CHNL3_RDATA2_ADDR A:0x241d020
y.create.l HWIO_PMIC_ARB_OBS0_CHNL0_CMD_ADDR A:0x2c00000
y.create.l HWIO_PMIC_ARB_OBS0_CHNL1_CMD_ADDR A:0x2c08000
y.create.l HWIO_PMIC_ARB_OBS0_CHNL2_CMD_ADDR A:0x2c10000
y.create.l HWIO_PMIC_ARB_OBS0_CHNL3_CMD_ADDR A:0x2c18000
y.create.l HWIO_PMIC_ARB_OBS1_CHNL0_CMD_ADDR A:0x2c01000
y.create.l HWIO_PMIC_ARB_OBS1_CHNL1_CMD_ADDR A:0x2c09000
y.create.l HWIO_PMIC_ARB_OBS1_CHNL2_CMD_ADDR A:0x2c11000
y.create.l HWIO_PMIC_ARB_OBS1_CHNL3_CMD_ADDR A:0x2c19000
y.create.l HWIO_PMIC_ARB_OBS2_CHNL0_CMD_ADDR A:0x2c02000
y.create.l HWIO_PMIC_ARB_OBS2_CHNL1_CMD_ADDR A:0x2c0a000
y.create.l HWIO_PMIC_ARB_OBS2_CHNL2_CMD_ADDR A:0x2c12000
y.create.l HWIO_PMIC_ARB_OBS2_CHNL3_CMD_ADDR A:0x2c1a000
y.create.l HWIO_PMIC_ARB_OBS3_CHNL0_CMD_ADDR A:0x2c03000
y.create.l HWIO_PMIC_ARB_OBS3_CHNL1_CMD_ADDR A:0x2c0b000
y.create.l HWIO_PMIC_ARB_OBS3_CHNL2_CMD_ADDR A:0x2c13000
y.create.l HWIO_PMIC_ARB_OBS3_CHNL3_CMD_ADDR A:0x2c1b000
y.create.l HWIO_PMIC_ARB_OBS4_CHNL0_CMD_ADDR A:0x2c04000
y.create.l HWIO_PMIC_ARB_OBS4_CHNL1_CMD_ADDR A:0x2c0c000
y.create.l HWIO_PMIC_ARB_OBS4_CHNL2_CMD_ADDR A:0x2c14000
y.create.l HWIO_PMIC_ARB_OBS4_CHNL3_CMD_ADDR A:0x2c1c000
y.create.l HWIO_PMIC_ARB_OBS5_CHNL0_CMD_ADDR A:0x2c05000
y.create.l HWIO_PMIC_ARB_OBS5_CHNL1_CMD_ADDR A:0x2c0d000
y.create.l HWIO_PMIC_ARB_OBS5_CHNL2_CMD_ADDR A:0x2c15000
y.create.l HWIO_PMIC_ARB_OBS5_CHNL3_CMD_ADDR A:0x2c1d000
y.create.l HWIO_PMIC_ARB_OBS0_CHNL0_CONFIG_ADDR A:0x2c00004
y.create.l HWIO_PMIC_ARB_OBS0_CHNL1_CONFIG_ADDR A:0x2c08004
y.create.l HWIO_PMIC_ARB_OBS0_CHNL2_CONFIG_ADDR A:0x2c10004
y.create.l HWIO_PMIC_ARB_OBS0_CHNL3_CONFIG_ADDR A:0x2c18004
y.create.l HWIO_PMIC_ARB_OBS1_CHNL0_CONFIG_ADDR A:0x2c01004
y.create.l HWIO_PMIC_ARB_OBS1_CHNL1_CONFIG_ADDR A:0x2c09004
y.create.l HWIO_PMIC_ARB_OBS1_CHNL2_CONFIG_ADDR A:0x2c11004
y.create.l HWIO_PMIC_ARB_OBS1_CHNL3_CONFIG_ADDR A:0x2c19004
y.create.l HWIO_PMIC_ARB_OBS2_CHNL0_CONFIG_ADDR A:0x2c02004
y.create.l HWIO_PMIC_ARB_OBS2_CHNL1_CONFIG_ADDR A:0x2c0a004
y.create.l HWIO_PMIC_ARB_OBS2_CHNL2_CONFIG_ADDR A:0x2c12004
y.create.l HWIO_PMIC_ARB_OBS2_CHNL3_CONFIG_ADDR A:0x2c1a004
y.create.l HWIO_PMIC_ARB_OBS3_CHNL0_CONFIG_ADDR A:0x2c03004
y.create.l HWIO_PMIC_ARB_OBS3_CHNL1_CONFIG_ADDR A:0x2c0b004
y.create.l HWIO_PMIC_ARB_OBS3_CHNL2_CONFIG_ADDR A:0x2c13004
y.create.l HWIO_PMIC_ARB_OBS3_CHNL3_CONFIG_ADDR A:0x2c1b004
y.create.l HWIO_PMIC_ARB_OBS4_CHNL0_CONFIG_ADDR A:0x2c04004
y.create.l HWIO_PMIC_ARB_OBS4_CHNL1_CONFIG_ADDR A:0x2c0c004
y.create.l HWIO_PMIC_ARB_OBS4_CHNL2_CONFIG_ADDR A:0x2c14004
y.create.l HWIO_PMIC_ARB_OBS4_CHNL3_CONFIG_ADDR A:0x2c1c004
y.create.l HWIO_PMIC_ARB_OBS5_CHNL0_CONFIG_ADDR A:0x2c05004
y.create.l HWIO_PMIC_ARB_OBS5_CHNL1_CONFIG_ADDR A:0x2c0d004
y.create.l HWIO_PMIC_ARB_OBS5_CHNL2_CONFIG_ADDR A:0x2c15004
y.create.l HWIO_PMIC_ARB_OBS5_CHNL3_CONFIG_ADDR A:0x2c1d004
y.create.l HWIO_PMIC_ARB_OBS0_CHNL0_STATUS_ADDR A:0x2c00008
y.create.l HWIO_PMIC_ARB_OBS0_CHNL1_STATUS_ADDR A:0x2c08008
y.create.l HWIO_PMIC_ARB_OBS0_CHNL2_STATUS_ADDR A:0x2c10008
y.create.l HWIO_PMIC_ARB_OBS0_CHNL3_STATUS_ADDR A:0x2c18008
y.create.l HWIO_PMIC_ARB_OBS1_CHNL0_STATUS_ADDR A:0x2c01008
y.create.l HWIO_PMIC_ARB_OBS1_CHNL1_STATUS_ADDR A:0x2c09008
y.create.l HWIO_PMIC_ARB_OBS1_CHNL2_STATUS_ADDR A:0x2c11008
y.create.l HWIO_PMIC_ARB_OBS1_CHNL3_STATUS_ADDR A:0x2c19008
y.create.l HWIO_PMIC_ARB_OBS2_CHNL0_STATUS_ADDR A:0x2c02008
y.create.l HWIO_PMIC_ARB_OBS2_CHNL1_STATUS_ADDR A:0x2c0a008
y.create.l HWIO_PMIC_ARB_OBS2_CHNL2_STATUS_ADDR A:0x2c12008
y.create.l HWIO_PMIC_ARB_OBS2_CHNL3_STATUS_ADDR A:0x2c1a008
y.create.l HWIO_PMIC_ARB_OBS3_CHNL0_STATUS_ADDR A:0x2c03008
y.create.l HWIO_PMIC_ARB_OBS3_CHNL1_STATUS_ADDR A:0x2c0b008
y.create.l HWIO_PMIC_ARB_OBS3_CHNL2_STATUS_ADDR A:0x2c13008
y.create.l HWIO_PMIC_ARB_OBS3_CHNL3_STATUS_ADDR A:0x2c1b008
y.create.l HWIO_PMIC_ARB_OBS4_CHNL0_STATUS_ADDR A:0x2c04008
y.create.l HWIO_PMIC_ARB_OBS4_CHNL1_STATUS_ADDR A:0x2c0c008
y.create.l HWIO_PMIC_ARB_OBS4_CHNL2_STATUS_ADDR A:0x2c14008
y.create.l HWIO_PMIC_ARB_OBS4_CHNL3_STATUS_ADDR A:0x2c1c008
y.create.l HWIO_PMIC_ARB_OBS5_CHNL0_STATUS_ADDR A:0x2c05008
y.create.l HWIO_PMIC_ARB_OBS5_CHNL1_STATUS_ADDR A:0x2c0d008
y.create.l HWIO_PMIC_ARB_OBS5_CHNL2_STATUS_ADDR A:0x2c15008
y.create.l HWIO_PMIC_ARB_OBS5_CHNL3_STATUS_ADDR A:0x2c1d008
y.create.l HWIO_PMIC_ARB_OBS0_CHNL0_RDATA0_ADDR A:0x2c00018
y.create.l HWIO_PMIC_ARB_OBS0_CHNL1_RDATA0_ADDR A:0x2c08018
y.create.l HWIO_PMIC_ARB_OBS0_CHNL2_RDATA0_ADDR A:0x2c10018
y.create.l HWIO_PMIC_ARB_OBS0_CHNL3_RDATA0_ADDR A:0x2c18018
y.create.l HWIO_PMIC_ARB_OBS1_CHNL0_RDATA0_ADDR A:0x2c01018
y.create.l HWIO_PMIC_ARB_OBS1_CHNL1_RDATA0_ADDR A:0x2c09018
y.create.l HWIO_PMIC_ARB_OBS1_CHNL2_RDATA0_ADDR A:0x2c11018
y.create.l HWIO_PMIC_ARB_OBS1_CHNL3_RDATA0_ADDR A:0x2c19018
y.create.l HWIO_PMIC_ARB_OBS2_CHNL0_RDATA0_ADDR A:0x2c02018
y.create.l HWIO_PMIC_ARB_OBS2_CHNL1_RDATA0_ADDR A:0x2c0a018
y.create.l HWIO_PMIC_ARB_OBS2_CHNL2_RDATA0_ADDR A:0x2c12018
y.create.l HWIO_PMIC_ARB_OBS2_CHNL3_RDATA0_ADDR A:0x2c1a018
y.create.l HWIO_PMIC_ARB_OBS3_CHNL0_RDATA0_ADDR A:0x2c03018
y.create.l HWIO_PMIC_ARB_OBS3_CHNL1_RDATA0_ADDR A:0x2c0b018
y.create.l HWIO_PMIC_ARB_OBS3_CHNL2_RDATA0_ADDR A:0x2c13018
y.create.l HWIO_PMIC_ARB_OBS3_CHNL3_RDATA0_ADDR A:0x2c1b018
y.create.l HWIO_PMIC_ARB_OBS4_CHNL0_RDATA0_ADDR A:0x2c04018
y.create.l HWIO_PMIC_ARB_OBS4_CHNL1_RDATA0_ADDR A:0x2c0c018
y.create.l HWIO_PMIC_ARB_OBS4_CHNL2_RDATA0_ADDR A:0x2c14018
y.create.l HWIO_PMIC_ARB_OBS4_CHNL3_RDATA0_ADDR A:0x2c1c018
y.create.l HWIO_PMIC_ARB_OBS5_CHNL0_RDATA0_ADDR A:0x2c05018
y.create.l HWIO_PMIC_ARB_OBS5_CHNL1_RDATA0_ADDR A:0x2c0d018
y.create.l HWIO_PMIC_ARB_OBS5_CHNL2_RDATA0_ADDR A:0x2c15018
y.create.l HWIO_PMIC_ARB_OBS5_CHNL3_RDATA0_ADDR A:0x2c1d018
y.create.l HWIO_PMIC_ARB_OBS0_CHNL0_RDATA1_ADDR A:0x2c0001c
y.create.l HWIO_PMIC_ARB_OBS0_CHNL1_RDATA1_ADDR A:0x2c0801c
y.create.l HWIO_PMIC_ARB_OBS0_CHNL2_RDATA1_ADDR A:0x2c1001c
y.create.l HWIO_PMIC_ARB_OBS0_CHNL3_RDATA1_ADDR A:0x2c1801c
y.create.l HWIO_PMIC_ARB_OBS1_CHNL0_RDATA1_ADDR A:0x2c0101c
y.create.l HWIO_PMIC_ARB_OBS1_CHNL1_RDATA1_ADDR A:0x2c0901c
y.create.l HWIO_PMIC_ARB_OBS1_CHNL2_RDATA1_ADDR A:0x2c1101c
y.create.l HWIO_PMIC_ARB_OBS1_CHNL3_RDATA1_ADDR A:0x2c1901c
y.create.l HWIO_PMIC_ARB_OBS2_CHNL0_RDATA1_ADDR A:0x2c0201c
y.create.l HWIO_PMIC_ARB_OBS2_CHNL1_RDATA1_ADDR A:0x2c0a01c
y.create.l HWIO_PMIC_ARB_OBS2_CHNL2_RDATA1_ADDR A:0x2c1201c
y.create.l HWIO_PMIC_ARB_OBS2_CHNL3_RDATA1_ADDR A:0x2c1a01c
y.create.l HWIO_PMIC_ARB_OBS3_CHNL0_RDATA1_ADDR A:0x2c0301c
y.create.l HWIO_PMIC_ARB_OBS3_CHNL1_RDATA1_ADDR A:0x2c0b01c
y.create.l HWIO_PMIC_ARB_OBS3_CHNL2_RDATA1_ADDR A:0x2c1301c
y.create.l HWIO_PMIC_ARB_OBS3_CHNL3_RDATA1_ADDR A:0x2c1b01c
y.create.l HWIO_PMIC_ARB_OBS4_CHNL0_RDATA1_ADDR A:0x2c0401c
y.create.l HWIO_PMIC_ARB_OBS4_CHNL1_RDATA1_ADDR A:0x2c0c01c
y.create.l HWIO_PMIC_ARB_OBS4_CHNL2_RDATA1_ADDR A:0x2c1401c
y.create.l HWIO_PMIC_ARB_OBS4_CHNL3_RDATA1_ADDR A:0x2c1c01c
y.create.l HWIO_PMIC_ARB_OBS5_CHNL0_RDATA1_ADDR A:0x2c0501c
y.create.l HWIO_PMIC_ARB_OBS5_CHNL1_RDATA1_ADDR A:0x2c0d01c
y.create.l HWIO_PMIC_ARB_OBS5_CHNL2_RDATA1_ADDR A:0x2c1501c
y.create.l HWIO_PMIC_ARB_OBS5_CHNL3_RDATA1_ADDR A:0x2c1d01c
y.create.l HWIO_PRNG_PRNG_DATA_OUT_ADDR A:0x22000
y.create.l HWIO_PRNG_PRNG_STATUS_ADDR A:0x22004
y.create.l HWIO_PRNG_PRNG_HW_VERSION_ADDR A:0x22008
y.create.l HWIO_PRNG_PRNG_ENTROPY_CNTR_ADDR A:0x22010
y.create.l HWIO_PRNG_PRNG_SAMPLE_CNTR_ADDR A:0x22014
y.create.l HWIO_PRNG_PRNG_GEN_CNTR_ADDR A:0x22018
y.create.l HWIO_PRNG_PRNG_RESEED_CNTR_ADDR A:0x2201c
y.create.l HWIO_PRNG_PRNG_INSTANTIATE_CNTR_ADDR A:0x22020
y.create.l HWIO_PRNG_PRNG_DEBUG_ADDR A:0x22024
y.create.l HWIO_PRNG_PRNG_LFSR_CFG_ADDR A:0x22100
y.create.l HWIO_PRNG_PRNG_CONFIG_ADDR A:0x22104
y.create.l HWIO_PRNG_PRNG_PERSONALIZATION_STRING_ADDR A:0x22108
y.create.l HWIO_PRNG_PRNG_NUM_ENTROPY_ADDR A:0x22110
y.create.l HWIO_PRNG_PRNG_SAMPLE_FREQ_ADDR A:0x22114
y.create.l HWIO_PRNG_PRNG_GEN_WORDS_ADDR A:0x22118
y.create.l HWIO_PRNG_PRNG_RESEED_FREQ_ADDR A:0x2211c
y.create.l HWIO_PRNG_PRNG_INSTANTIATE_FREQ_ADDR A:0x22120
y.create.l HWIO_QDSS_NDPBAM_BAM_CTRL_ADDR A:0x6084000
y.create.l HWIO_QDSS_NDPBAM_BAM_TIMER_ADDR A:0x6084040
y.create.l HWIO_QDSS_NDPBAM_BAM_TIMER_CTRL_ADDR A:0x6084044
y.create.l HWIO_QDSS_NDPBAM_BAM_DESC_CNT_TRSHLD_ADDR A:0x6084008
y.create.l HWIO_QDSS_NDPBAM_BAM_IRQ_STTS_ADDR A:0x6084014
y.create.l HWIO_QDSS_NDPBAM_BAM_IRQ_CLR_ADDR A:0x6084018
y.create.l HWIO_QDSS_NDPBAM_BAM_IRQ_EN_ADDR A:0x608401c
y.create.l HWIO_QDSS_NDPBAM_BAM_CNFG_BITS_ADDR A:0x608407c
y.create.l HWIO_QDSS_NDPBAM_BAM_CNFG_BITS_2_ADDR A:0x6084084
y.create.l HWIO_QDSS_NDPBAM_BAM_REVISION_ADDR A:0x6085000
y.create.l HWIO_QDSS_NDPBAM_BAM_SW_VERSION_ADDR A:0x6085004
y.create.l HWIO_QDSS_NDPBAM_BAM_NUM_PIPES_ADDR A:0x6085008
y.create.l HWIO_QDSS_NDPBAM_BAM_TEST_BUS_SEL_ADDR A:0x6085010
y.create.l HWIO_QDSS_NDPBAM_BAM_TEST_BUS_REG_ADDR A:0x6085014
y.create.l HWIO_QDSS_NDPBAM_BAM_AHB_MASTER_ERR_CTRLS_ADDR A:0x6085024
y.create.l HWIO_QDSS_NDPBAM_BAM_AHB_MASTER_ERR_ADDR_ADDR A:0x6085028
y.create.l HWIO_QDSS_NDPBAM_BAM_AHB_MASTER_ERR_DATA_ADDR A:0x608502c
y.create.l HWIO_QDSS_NDPBAM_BAM_AHB_MASTER_ERR_ADDR_LSB_ADDR A:0x6085100
y.create.l HWIO_QDSS_NDPBAM_BAM_AHB_MASTER_ERR_ADDR_MSB_ADDR A:0x6085104
y.create.l HWIO_QDSS_NDPBAM_BAM_TRUST_REG_ADDR A:0x6086000
y.create.l HWIO_QDSS_NDPBAM_BAM_P_TRUST_REG0_ADDR A:0x6086020
y.create.l HWIO_QDSS_NDPBAM_BAM_P_TRUST_REG1_ADDR A:0x6086024
y.create.l HWIO_QDSS_NDPBAM_BAM_IRQ_SRCS_EE0_ADDR A:0x6087000
y.create.l HWIO_QDSS_NDPBAM_BAM_IRQ_SRCS_EE1_ADDR A:0x6088000
y.create.l HWIO_QDSS_NDPBAM_BAM_IRQ_SRCS_EE2_ADDR A:0x6089000
y.create.l HWIO_QDSS_NDPBAM_BAM_IRQ_SRCS_EE3_ADDR A:0x608a000
y.create.l HWIO_QDSS_NDPBAM_BAM_IRQ_SRCS_EE4_ADDR A:0x608b000
y.create.l HWIO_QDSS_NDPBAM_BAM_IRQ_SRCS_EE5_ADDR A:0x608c000
y.create.l HWIO_QDSS_NDPBAM_BAM_IRQ_SRCS_EE6_ADDR A:0x608d000
y.create.l HWIO_QDSS_NDPBAM_BAM_IRQ_SRCS_EE7_ADDR A:0x608e000
y.create.l HWIO_QDSS_NDPBAM_BAM_IRQ_SRCS_MSK_EE0_ADDR A:0x6087004
y.create.l HWIO_QDSS_NDPBAM_BAM_IRQ_SRCS_MSK_EE1_ADDR A:0x6088004
y.create.l HWIO_QDSS_NDPBAM_BAM_IRQ_SRCS_MSK_EE2_ADDR A:0x6089004
y.create.l HWIO_QDSS_NDPBAM_BAM_IRQ_SRCS_MSK_EE3_ADDR A:0x608a004
y.create.l HWIO_QDSS_NDPBAM_BAM_IRQ_SRCS_MSK_EE4_ADDR A:0x608b004
y.create.l HWIO_QDSS_NDPBAM_BAM_IRQ_SRCS_MSK_EE5_ADDR A:0x608c004
y.create.l HWIO_QDSS_NDPBAM_BAM_IRQ_SRCS_MSK_EE6_ADDR A:0x608d004
y.create.l HWIO_QDSS_NDPBAM_BAM_IRQ_SRCS_MSK_EE7_ADDR A:0x608e004
y.create.l HWIO_QDSS_NDPBAM_BAM_IRQ_SRCS_UNMASKED_EE0_ADDR A:0x6087008
y.create.l HWIO_QDSS_NDPBAM_BAM_IRQ_SRCS_UNMASKED_EE1_ADDR A:0x6088008
y.create.l HWIO_QDSS_NDPBAM_BAM_IRQ_SRCS_UNMASKED_EE2_ADDR A:0x6089008
y.create.l HWIO_QDSS_NDPBAM_BAM_IRQ_SRCS_UNMASKED_EE3_ADDR A:0x608a008
y.create.l HWIO_QDSS_NDPBAM_BAM_IRQ_SRCS_UNMASKED_EE4_ADDR A:0x608b008
y.create.l HWIO_QDSS_NDPBAM_BAM_IRQ_SRCS_UNMASKED_EE5_ADDR A:0x608c008
y.create.l HWIO_QDSS_NDPBAM_BAM_IRQ_SRCS_UNMASKED_EE6_ADDR A:0x608d008
y.create.l HWIO_QDSS_NDPBAM_BAM_IRQ_SRCS_UNMASKED_EE7_ADDR A:0x608e008
y.create.l HWIO_QDSS_NDPBAM_BAM_PIPE_ATTR_EE0_ADDR A:0x608700c
y.create.l HWIO_QDSS_NDPBAM_BAM_PIPE_ATTR_EE1_ADDR A:0x608800c
y.create.l HWIO_QDSS_NDPBAM_BAM_PIPE_ATTR_EE2_ADDR A:0x608900c
y.create.l HWIO_QDSS_NDPBAM_BAM_PIPE_ATTR_EE3_ADDR A:0x608a00c
y.create.l HWIO_QDSS_NDPBAM_BAM_PIPE_ATTR_EE4_ADDR A:0x608b00c
y.create.l HWIO_QDSS_NDPBAM_BAM_PIPE_ATTR_EE5_ADDR A:0x608c00c
y.create.l HWIO_QDSS_NDPBAM_BAM_PIPE_ATTR_EE6_ADDR A:0x608d00c
y.create.l HWIO_QDSS_NDPBAM_BAM_PIPE_ATTR_EE7_ADDR A:0x608e00c
y.create.l HWIO_QDSS_NDPBAM_BAM_IRQ_SRCS_ADDR A:0x6087010
y.create.l HWIO_QDSS_NDPBAM_BAM_IRQ_SRCS_MSK_ADDR A:0x6087014
y.create.l HWIO_QDSS_NDPBAM_BAM_IRQ_SRCS_UNMASKED_ADDR A:0x6087018
y.create.l HWIO_QDSS_NDPBAM_BAM_P_CTRL0_ADDR A:0x6097000
y.create.l HWIO_QDSS_NDPBAM_BAM_P_CTRL1_ADDR A:0x6098000
y.create.l HWIO_QDSS_NDPBAM_BAM_P_RST0_ADDR A:0x6097004
y.create.l HWIO_QDSS_NDPBAM_BAM_P_RST1_ADDR A:0x6098004
y.create.l HWIO_QDSS_NDPBAM_BAM_P_HALT0_ADDR A:0x6097008
y.create.l HWIO_QDSS_NDPBAM_BAM_P_HALT1_ADDR A:0x6098008
y.create.l HWIO_QDSS_NDPBAM_BAM_P_IRQ_STTS0_ADDR A:0x6097010
y.create.l HWIO_QDSS_NDPBAM_BAM_P_IRQ_STTS1_ADDR A:0x6098010
y.create.l HWIO_QDSS_NDPBAM_BAM_P_IRQ_CLR0_ADDR A:0x6097014
y.create.l HWIO_QDSS_NDPBAM_BAM_P_IRQ_CLR1_ADDR A:0x6098014
y.create.l HWIO_QDSS_NDPBAM_BAM_P_IRQ_EN0_ADDR A:0x6097018
y.create.l HWIO_QDSS_NDPBAM_BAM_P_IRQ_EN1_ADDR A:0x6098018
y.create.l HWIO_QDSS_NDPBAM_BAM_P_TIMER0_ADDR A:0x609701c
y.create.l HWIO_QDSS_NDPBAM_BAM_P_TIMER1_ADDR A:0x609801c
y.create.l HWIO_QDSS_NDPBAM_BAM_P_TIMER_CTRL0_ADDR A:0x6097020
y.create.l HWIO_QDSS_NDPBAM_BAM_P_TIMER_CTRL1_ADDR A:0x6098020
y.create.l HWIO_QDSS_NDPBAM_BAM_P_PRDCR_SDBND0_ADDR A:0x6097024
y.create.l HWIO_QDSS_NDPBAM_BAM_P_PRDCR_SDBND1_ADDR A:0x6098024
y.create.l HWIO_QDSS_NDPBAM_BAM_P_CNSMR_SDBND0_ADDR A:0x6097028
y.create.l HWIO_QDSS_NDPBAM_BAM_P_CNSMR_SDBND1_ADDR A:0x6098028
y.create.l HWIO_QDSS_NDPBAM_BAM_P_SW_OFSTS0_ADDR A:0x6097800
y.create.l HWIO_QDSS_NDPBAM_BAM_P_SW_OFSTS1_ADDR A:0x6098800
y.create.l HWIO_QDSS_NDPBAM_BAM_P_AU_PSM_CNTXT_1_0_ADDR A:0x6097804
y.create.l HWIO_QDSS_NDPBAM_BAM_P_AU_PSM_CNTXT_1_1_ADDR A:0x6098804
y.create.l HWIO_QDSS_NDPBAM_BAM_P_PSM_CNTXT_2_0_ADDR A:0x6097808
y.create.l HWIO_QDSS_NDPBAM_BAM_P_PSM_CNTXT_2_1_ADDR A:0x6098808
y.create.l HWIO_QDSS_NDPBAM_BAM_P_PSM_CNTXT_3_0_ADDR A:0x609780c
y.create.l HWIO_QDSS_NDPBAM_BAM_P_PSM_CNTXT_3_1_ADDR A:0x609880c
y.create.l HWIO_QDSS_NDPBAM_BAM_P_PSM_CNTXT_4_0_ADDR A:0x6097810
y.create.l HWIO_QDSS_NDPBAM_BAM_P_PSM_CNTXT_4_1_ADDR A:0x6098810
y.create.l HWIO_QDSS_NDPBAM_BAM_P_PSM_CNTXT_5_0_ADDR A:0x6097814
y.create.l HWIO_QDSS_NDPBAM_BAM_P_PSM_CNTXT_5_1_ADDR A:0x6098814
y.create.l HWIO_QDSS_NDPBAM_BAM_P_EVNT_REG0_ADDR A:0x6097818
y.create.l HWIO_QDSS_NDPBAM_BAM_P_EVNT_REG1_ADDR A:0x6098818
y.create.l HWIO_QDSS_NDPBAM_BAM_P_DESC_FIFO_ADDR0_ADDR A:0x609781c
y.create.l HWIO_QDSS_NDPBAM_BAM_P_DESC_FIFO_ADDR1_ADDR A:0x609881c
y.create.l HWIO_QDSS_NDPBAM_BAM_P_FIFO_SIZES0_ADDR A:0x6097820
y.create.l HWIO_QDSS_NDPBAM_BAM_P_FIFO_SIZES1_ADDR A:0x6098820
y.create.l HWIO_QDSS_NDPBAM_BAM_P_DATA_FIFO_ADDR0_ADDR A:0x6097824
y.create.l HWIO_QDSS_NDPBAM_BAM_P_DATA_FIFO_ADDR1_ADDR A:0x6098824
y.create.l HWIO_QDSS_NDPBAM_BAM_P_EVNT_GEN_TRSHLD0_ADDR A:0x6097828
y.create.l HWIO_QDSS_NDPBAM_BAM_P_EVNT_GEN_TRSHLD1_ADDR A:0x6098828
y.create.l HWIO_QDSS_NDPBAM_BAM_P_EVNT_DEST_ADDR0_ADDR A:0x609782c
y.create.l HWIO_QDSS_NDPBAM_BAM_P_EVNT_DEST_ADDR1_ADDR A:0x609882c
y.create.l HWIO_QDSS_NDPBAM_BAM_P_DF_CNTXT_0_ADDR A:0x6097830
y.create.l HWIO_QDSS_NDPBAM_BAM_P_DF_CNTXT_1_ADDR A:0x6098830
y.create.l HWIO_QDSS_NDPBAM_BAM_P_RETR_CNTXT_0_ADDR A:0x6097834
y.create.l HWIO_QDSS_NDPBAM_BAM_P_RETR_CNTXT_1_ADDR A:0x6098834
y.create.l HWIO_QDSS_NDPBAM_BAM_P_SI_CNTXT_0_ADDR A:0x6097838
y.create.l HWIO_QDSS_NDPBAM_BAM_P_SI_CNTXT_1_ADDR A:0x6098838
y.create.l HWIO_QDSS_NDPBAM_BAM_P_PSM_CNTXT_3_LSB0_ADDR A:0x6097900
y.create.l HWIO_QDSS_NDPBAM_BAM_P_PSM_CNTXT_3_LSB1_ADDR A:0x6098900
y.create.l HWIO_QDSS_NDPBAM_BAM_P_PSM_CNTXT_3_MSB0_ADDR A:0x6097904
y.create.l HWIO_QDSS_NDPBAM_BAM_P_PSM_CNTXT_3_MSB1_ADDR A:0x6098904
y.create.l HWIO_QDSS_NDPBAM_BAM_P_DESC_FIFO_ADDR_LSB0_ADDR A:0x6097910
y.create.l HWIO_QDSS_NDPBAM_BAM_P_DESC_FIFO_ADDR_LSB1_ADDR A:0x6098910
y.create.l HWIO_QDSS_NDPBAM_BAM_P_DESC_FIFO_ADDR_MSB0_ADDR A:0x6097914
y.create.l HWIO_QDSS_NDPBAM_BAM_P_DESC_FIFO_ADDR_MSB1_ADDR A:0x6098914
y.create.l HWIO_QDSS_NDPBAM_BAM_P_DATA_FIFO_ADDR_LSB0_ADDR A:0x6097920
y.create.l HWIO_QDSS_NDPBAM_BAM_P_DATA_FIFO_ADDR_LSB1_ADDR A:0x6098920
y.create.l HWIO_QDSS_NDPBAM_BAM_P_DATA_FIFO_ADDR_MSB0_ADDR A:0x6097924
y.create.l HWIO_QDSS_NDPBAM_BAM_P_DATA_FIFO_ADDR_MSB1_ADDR A:0x6098924
y.create.l HWIO_QDSS_NDPBAM_BAM_P_EVNT_DEST_ADDR_LSB0_ADDR A:0x6097930
y.create.l HWIO_QDSS_NDPBAM_BAM_P_EVNT_DEST_ADDR_LSB1_ADDR A:0x6098930
y.create.l HWIO_QDSS_NDPBAM_BAM_P_EVNT_DEST_ADDR_MSB0_ADDR A:0x6097934
y.create.l HWIO_QDSS_NDPBAM_BAM_P_EVNT_DEST_ADDR_MSB1_ADDR A:0x6098934
y.create.l HWIO_QDSS_CORESIGHT_CSR_ROM_WORD_ADDR A:0x6000000
y.create.l HWIO_QDSS_STM_ROM_WORD_ADDR A:0x6000004
y.create.l HWIO_QDSS_CTI0_ROM_WORD_ADDR A:0x6000008
y.create.l HWIO_QDSS_CTI1_ROM_WORD_ADDR A:0x600000c
y.create.l HWIO_QDSS_CTI2_ROM_WORD_ADDR A:0x6000010
y.create.l HWIO_QDSS_CTI3_ROM_WORD_ADDR A:0x6000014
y.create.l HWIO_QDSS_CTI4_ROM_WORD_ADDR A:0x6000018
y.create.l HWIO_QDSS_CTI5_ROM_WORD_ADDR A:0x600001c
y.create.l HWIO_QDSS_CTI6_ROM_WORD_ADDR A:0x6000020
y.create.l HWIO_QDSS_CTI7_ROM_WORD_ADDR A:0x6000024
y.create.l HWIO_QDSS_CTI8_ROM_WORD_ADDR A:0x6000028
y.create.l HWIO_QDSS_TPIU_ROM_WORD_ADDR A:0x600002c
y.create.l HWIO_QDSS_TFUN0_ROM_WORD_ADDR A:0x6000030
y.create.l HWIO_QDSS_TREPL_ROM_WORD_ADDR A:0x6000034
y.create.l HWIO_QDSS_ETBETF_ROM_WORD_ADDR A:0x6000038
y.create.l HWIO_QDSS_ETR_ROM_WORD_ADDR A:0x600003c
y.create.l HWIO_QDSS_VENUS_CTI_ROM_WORD_ADDR A:0x6000040
y.create.l HWIO_QDSS_VENUS_A9_ETM_ROM_WORD_ADDR A:0x6000044
y.create.l HWIO_QDSS_PRONTO_A9_ETM_ROM_WORD_ADDR A:0x6000048
y.create.l HWIO_QDSS_PRONTO_A9_CTI_ROM_WORD_ADDR A:0x600004c
y.create.l HWIO_QDSS_MSS_Q6_CTI_ROM_WORD_ADDR A:0x6000050
y.create.l HWIO_QDSS_RPM_CM3_CTI_ROM_WORD_ADDR A:0x6000054
y.create.l HWIO_QDSS_A7SS_PC0_DBG_ROM_WORD_ADDR A:0x6000058
y.create.l HWIO_QDSS_A7SS_PC0_PM_ROM_WORD_ADDR A:0x600005c
y.create.l HWIO_QDSS_A7SS_PC1_DBG_ROM_WORD_ADDR A:0x6000060
y.create.l HWIO_QDSS_A7SS_PC1_PM_ROM_WORD_ADDR A:0x6000064
y.create.l HWIO_QDSS_A7SS_PC2_DBG_ROM_WORD_ADDR A:0x6000068
y.create.l HWIO_QDSS_A7SS_PC2_PM_ROM_WORD_ADDR A:0x600006c
y.create.l HWIO_QDSS_A7SS_PC3_DBG_ROM_WORD_ADDR A:0x6000070
y.create.l HWIO_QDSS_A7SS_PC3_PM_ROM_WORD_ADDR A:0x6000074
y.create.l HWIO_QDSS_A7SS_PC0_ETM_ROM_WORD_ADDR A:0x6000078
y.create.l HWIO_QDSS_A7SS_PC1_ETM_ROM_WORD_ADDR A:0x600007c
y.create.l HWIO_QDSS_A7SS_PC2_ETM_ROM_WORD_ADDR A:0x6000080
y.create.l HWIO_QDSS_A7SS_PC3_ETM_ROM_WORD_ADDR A:0x6000084
y.create.l HWIO_QDSS_A7SS_PC0_CTI_ROM_WORD_ADDR A:0x6000088
y.create.l HWIO_QDSS_A7SS_PC1_CTI_ROM_WORD_ADDR A:0x600008c
y.create.l HWIO_QDSS_A7SS_PC2_CTI_ROM_WORD_ADDR A:0x6000090
y.create.l HWIO_QDSS_A7SS_PC3_CTI_ROM_WORD_ADDR A:0x6000094
y.create.l HWIO_QDSS_A7SS_TFUNNEL_ROM_WORD_ADDR A:0x6000098
y.create.l HWIO_QDSS_QDSS_WRAPPER_2X1_FUNNEL_ROM_WORD_ADDR A:0x600009c
y.create.l HWIO_QDSS_QDSS_WRAPPER_8X1_FUNNEL_ROM_WORD_ADDR A:0x60000a0
y.create.l HWIO_QDSS_HWE_EXPD_MUX_CFG_ROM_WORD_ADDR A:0x60000a4
y.create.l HWIO_QDSS_DBGUI_CFG_ROM_WORD_ADDR A:0x60000a8
y.create.l HWIO_QDSS_DAPROM_PERIPHERAL_ID4_ADDR A:0x6000fd0
y.create.l HWIO_QDSS_DAPROM_PERIPHERAL_ID5_ADDR A:0x6000fd4
y.create.l HWIO_QDSS_DAPROM_PERIPHERAL_ID6_ADDR A:0x6000fd8
y.create.l HWIO_QDSS_DAPROM_PERIPHERAL_ID7_ADDR A:0x6000fdc
y.create.l HWIO_QDSS_DAPROM_PERIPHERAL_ID0_ADDR A:0x6000fe0
y.create.l HWIO_QDSS_DAPROM_PERIPHERAL_ID1_ADDR A:0x6000fe4
y.create.l HWIO_QDSS_DAPROM_PERIPHERAL_ID2_ADDR A:0x6000fe8
y.create.l HWIO_QDSS_DAPROM_PERIPHERAL_ID3_ADDR A:0x6000fec
y.create.l HWIO_QDSS_DAPROM_COMPONENT_ID0_ADDR A:0x6000ff0
y.create.l HWIO_QDSS_DAPROM_COMPONENT_ID1_ADDR A:0x6000ff4
y.create.l HWIO_QDSS_DAPROM_COMPONENT_ID2_ADDR A:0x6000ff8
y.create.l HWIO_QDSS_DAPROM_COMPONENT_ID3_ADDR A:0x6000ffc
y.create.l HWIO_QDSS_CS_QDSSCSR_SWDBGPWRCTRL_ADDR A:0x6001000
y.create.l HWIO_QDSS_CS_QDSSCSR_SWDBGPWRACK_ADDR A:0x6001004
y.create.l HWIO_QDSS_CS_QDSSCSR_SWSPADREG0_ADDR A:0x6001008
y.create.l HWIO_QDSS_CS_QDSSCSR_SWSPADREG1_ADDR A:0x600100c
y.create.l HWIO_QDSS_CS_QDSSCSR_STMTRANSCTRL_ADDR A:0x6001010
y.create.l HWIO_QDSS_CS_QDSSCSR_STMAWIDCTRL_ADDR A:0x6001014
y.create.l HWIO_QDSS_CS_QDSSCSR_STMCHNOFST0_ADDR A:0x6001018
y.create.l HWIO_QDSS_CS_QDSSCSR_STMCHNOFST1_ADDR A:0x600101c
y.create.l HWIO_QDSS_CS_QDSSCSR_STMEXTHWCTRL0_ADDR A:0x6001020
y.create.l HWIO_QDSS_CS_QDSSCSR_STMEXTHWCTRL1_ADDR A:0x6001024
y.create.l HWIO_QDSS_CS_QDSSCSR_STMEXTHWCTRL2_ADDR A:0x6001028
y.create.l HWIO_QDSS_CS_QDSSCSR_STMEXTHWCTRL3_ADDR A:0x600102c
y.create.l HWIO_QDSS_CS_QDSSCSR_USBBAMCTRL_ADDR A:0x6001030
y.create.l HWIO_QDSS_CS_QDSSCSR_USBFLSHCTRL_ADDR A:0x6001034
y.create.l HWIO_QDSS_CS_QDSSCSR_TIMESTAMPCTRL_ADDR A:0x6001038
y.create.l HWIO_QDSS_CS_QDSSCSR_AOTIMEVAL0_ADDR A:0x600103c
y.create.l HWIO_QDSS_CS_QDSSCSR_AOTIMEVAL1_ADDR A:0x6001040
y.create.l HWIO_QDSS_CS_QDSSCSR_QDSSTIMEVAL0_ADDR A:0x6001044
y.create.l HWIO_QDSS_CS_QDSSCSR_QDSSTIMEVAL1_ADDR A:0x6001048
y.create.l HWIO_QDSS_CS_QDSSCSR_QDSSTIMELOAD0_ADDR A:0x600104c
y.create.l HWIO_QDSS_CS_QDSSCSR_QDSSTIMELOAD1_ADDR A:0x6001050
y.create.l HWIO_QDSS_CS_QDSSCSR_DAPMSAVAL_ADDR A:0x6001054
y.create.l HWIO_QDSS_CS_QDSSCSR_QDSSCLKVOTE_ADDR A:0x6001058
y.create.l HWIO_QDSS_CS_QDSSCSR_QDSSCLKIPI_ADDR A:0x600105c
y.create.l HWIO_QDSS_CS_QDSSCSR_QDSSPWRREQIGNORE_ADDR A:0x6001060
y.create.l HWIO_QDSS_CS_QDSSCSR_QDSSSPARE_ADDR A:0x6001064
y.create.l HWIO_QDSS_CS_QDSSCSR_IPCAT_ADDR A:0x6001068
y.create.l HWIO_QDSS_CS_QDSSCSR_ETRIRQCTRL_ADDR A:0x600106c
y.create.l HWIO_QDSS_CS_QDSSCSR_PRESERVEETF_ADDR A:0x6001070
y.create.l HWIO_QDSS_CS_QDSSCSR_PRESERVEETR0_ADDR A:0x6001074
y.create.l HWIO_QDSS_CS_QDSSCSR_PRESERVEETR1_ADDR A:0x6001078
y.create.l HWIO_QDSS_CS_QDSSCSR_ITCTL_ADDR A:0x6001f00
y.create.l HWIO_QDSS_CS_QDSSCSR_CLAIMSET_ADDR A:0x6001fa0
y.create.l HWIO_QDSS_CS_QDSSCSR_CLAIMCLR_ADDR A:0x6001fa4
y.create.l HWIO_QDSS_CS_QDSSCSR_LOCKACCESS_ADDR A:0x6001fb0
y.create.l HWIO_QDSS_CS_QDSSCSR_LOCKSTATUS_ADDR A:0x6001fb4
y.create.l HWIO_QDSS_CS_QDSSCSR_AUTHSTATUS_ADDR A:0x6001fb8
y.create.l HWIO_QDSS_CS_QDSSCSR_DEVICEID_ADDR A:0x6001fc8
y.create.l HWIO_QDSS_CS_QDSSCSR_DEVICETYPE_ADDR A:0x6001fcc
y.create.l HWIO_QDSS_CS_QDSSCSR_PERIPHID4_ADDR A:0x6001fd0
y.create.l HWIO_QDSS_CS_QDSSCSR_PERIPHID5_ADDR A:0x6001fd4
y.create.l HWIO_QDSS_CS_QDSSCSR_PERIPHID6_ADDR A:0x6001fd8
y.create.l HWIO_QDSS_CS_QDSSCSR_PERIPHID7_ADDR A:0x6001fdc
y.create.l HWIO_QDSS_CS_QDSSCSR_PERIPHID0_ADDR A:0x6001fe0
y.create.l HWIO_QDSS_CS_QDSSCSR_PERIPHID1_ADDR A:0x6001fe4
y.create.l HWIO_QDSS_CS_QDSSCSR_PERIPHID2_ADDR A:0x6001fe8
y.create.l HWIO_QDSS_CS_QDSSCSR_PERIPHID3_ADDR A:0x6001fec
y.create.l HWIO_QDSS_CS_QDSSCSR_COMPID0_ADDR A:0x6001ff0
y.create.l HWIO_QDSS_CS_QDSSCSR_COMPID1_ADDR A:0x6001ff4
y.create.l HWIO_QDSS_CS_QDSSCSR_COMPID2_ADDR A:0x6001ff8
y.create.l HWIO_QDSS_CS_QDSSCSR_COMPID3_ADDR A:0x6001ffc
y.create.l HWIO_QDSS_STMDMASTARTR_ADDR A:0x6002c04
y.create.l HWIO_QDSS_STMDMASTOPR_ADDR A:0x6002c08
y.create.l HWIO_QDSS_STMDMASTATR_ADDR A:0x6002c0c
y.create.l HWIO_QDSS_STMDMACTLR_ADDR A:0x6002c10
y.create.l HWIO_QDSS_STMDMAIDR_ADDR A:0x6002cfc
y.create.l HWIO_QDSS_STMHEER_ADDR A:0x6002d00
y.create.l HWIO_QDSS_STMHETER_ADDR A:0x6002d20
y.create.l HWIO_QDSS_STMHEMCR_ADDR A:0x6002d64
y.create.l HWIO_QDSS_STMHEMASTR_ADDR A:0x6002df4
y.create.l HWIO_QDSS_STMHEFEAT1R_ADDR A:0x6002df8
y.create.l HWIO_QDSS_STMHEIDR_ADDR A:0x6002dfc
y.create.l HWIO_QDSS_STMSPER_ADDR A:0x6002e00
y.create.l HWIO_QDSS_STMSPTER_ADDR A:0x6002e20
y.create.l HWIO_QDSS_STMSPSCR_ADDR A:0x6002e60
y.create.l HWIO_QDSS_STMSPMSCR_ADDR A:0x6002e64
y.create.l HWIO_QDSS_STMSPOVERRIDER_ADDR A:0x6002e68
y.create.l HWIO_QDSS_STMSPMOVERRIDER_ADDR A:0x6002e6c
y.create.l HWIO_QDSS_STMSPTRIGCSR_ADDR A:0x6002e70
y.create.l HWIO_QDSS_STMTCSR_ADDR A:0x6002e80
y.create.l HWIO_QDSS_STMTSSTIMR_ADDR A:0x6002e84
y.create.l HWIO_QDSS_STMTSFREQR_ADDR A:0x6002e8c
y.create.l HWIO_QDSS_STMSYNCR_ADDR A:0x6002e90
y.create.l HWIO_QDSS_STMAUXCR_ADDR A:0x6002e94
y.create.l HWIO_QDSS_STMSPFEAT1R_ADDR A:0x6002ea0
y.create.l HWIO_QDSS_STMSPFEAT2R_ADDR A:0x6002ea4
y.create.l HWIO_QDSS_STMSPFEAT3R_ADDR A:0x6002ea8
y.create.l HWIO_QDSS_STMITTRIGGER_ADDR A:0x6002ee8
y.create.l HWIO_QDSS_STMITATBDATA0_ADDR A:0x6002eec
y.create.l HWIO_QDSS_STMITATBCTR2_ADDR A:0x6002ef0
y.create.l HWIO_QDSS_STMITATBID_ADDR A:0x6002ef4
y.create.l HWIO_QDSS_STMITATBCTR0_ADDR A:0x6002ef8
y.create.l HWIO_QDSS_STMITCTRL_ADDR A:0x6002f00
y.create.l HWIO_QDSS_STMCLAIMSET_ADDR A:0x6002fa0
y.create.l HWIO_QDSS_STMCLAIMCLR_ADDR A:0x6002fa4
y.create.l HWIO_QDSS_STMLAR_ADDR A:0x6002fb0
y.create.l HWIO_QDSS_STMLSR_ADDR A:0x6002fb4
y.create.l HWIO_QDSS_STMAUTHSTATUS_ADDR A:0x6002fb8
y.create.l HWIO_QDSS_STMDEVID_ADDR A:0x6002fc8
y.create.l HWIO_QDSS_STMDEVTYPE_ADDR A:0x6002fcc
y.create.l HWIO_QDSS_STMPIDR0_ADDR A:0x6002fe0
y.create.l HWIO_QDSS_STMPIDR1_ADDR A:0x6002fe4
y.create.l HWIO_QDSS_STMPIDR2_ADDR A:0x6002fe8
y.create.l HWIO_QDSS_STMPIDR3_ADDR A:0x6002fec
y.create.l HWIO_QDSS_STMPIDR4_ADDR A:0x6002fd0
y.create.l HWIO_QDSS_STMPIDR5_ADDR A:0x6002fd4
y.create.l HWIO_QDSS_STMPIDR6_ADDR A:0x6002fd8
y.create.l HWIO_QDSS_STMPIDR7_ADDR A:0x6002fdc
y.create.l HWIO_QDSS_STMCIDR0_ADDR A:0x6002ff0
y.create.l HWIO_QDSS_STMCIDR1_ADDR A:0x6002ff4
y.create.l HWIO_QDSS_STMCIDR2_ADDR A:0x6002ff8
y.create.l HWIO_QDSS_STMCIDR3_ADDR A:0x6002ffc
y.create.l HWIO_QDSS_CTI0_CTICONTROL_ADDR A:0x6010000
y.create.l HWIO_QDSS_CTI0_CTIINTACK_ADDR A:0x6010010
y.create.l HWIO_QDSS_CTI0_CTIAPPSET_ADDR A:0x6010014
y.create.l HWIO_QDSS_CTI0_CTIAPPCLEAR_ADDR A:0x6010018
y.create.l HWIO_QDSS_CTI0_CTIAPPPULSE_ADDR A:0x601001c
y.create.l HWIO_QDSS_CTI0_CTIINEN0_ADDR A:0x6010020
y.create.l HWIO_QDSS_CTI0_CTIINEN1_ADDR A:0x6010024
y.create.l HWIO_QDSS_CTI0_CTIINEN2_ADDR A:0x6010028
y.create.l HWIO_QDSS_CTI0_CTIINEN3_ADDR A:0x601002c
y.create.l HWIO_QDSS_CTI0_CTIINEN4_ADDR A:0x6010030
y.create.l HWIO_QDSS_CTI0_CTIINEN5_ADDR A:0x6010034
y.create.l HWIO_QDSS_CTI0_CTIINEN6_ADDR A:0x6010038
y.create.l HWIO_QDSS_CTI0_CTIINEN7_ADDR A:0x601003c
y.create.l HWIO_QDSS_CTI0_CTIOUTEN0_ADDR A:0x60100a0
y.create.l HWIO_QDSS_CTI0_CTIOUTEN1_ADDR A:0x60100a4
y.create.l HWIO_QDSS_CTI0_CTIOUTEN2_ADDR A:0x60100a8
y.create.l HWIO_QDSS_CTI0_CTIOUTEN3_ADDR A:0x60100ac
y.create.l HWIO_QDSS_CTI0_CTIOUTEN4_ADDR A:0x60100b0
y.create.l HWIO_QDSS_CTI0_CTIOUTEN5_ADDR A:0x60100b4
y.create.l HWIO_QDSS_CTI0_CTIOUTEN6_ADDR A:0x60100b8
y.create.l HWIO_QDSS_CTI0_CTIOUTEN7_ADDR A:0x60100bc
y.create.l HWIO_QDSS_CTI0_CTITRIGINSTATUS_ADDR A:0x6010130
y.create.l HWIO_QDSS_CTI0_CTITRIGOUTSTATUS_ADDR A:0x6010134
y.create.l HWIO_QDSS_CTI0_CTICHINSTATUS_ADDR A:0x6010138
y.create.l HWIO_QDSS_CTI0_CTICHOUTSTATUS_ADDR A:0x601013c
y.create.l HWIO_QDSS_CTI0_CTIGATE_ADDR A:0x6010140
y.create.l HWIO_QDSS_CTI0_ASICCTL_ADDR A:0x6010144
y.create.l HWIO_QDSS_CTI0_ITCHINACK_ADDR A:0x6010edc
y.create.l HWIO_QDSS_CTI0_ITTRIGINACK_ADDR A:0x6010ee0
y.create.l HWIO_QDSS_CTI0_ITCHOUT_ADDR A:0x6010ee4
y.create.l HWIO_QDSS_CTI0_ITTRIGOUT_ADDR A:0x6010ee8
y.create.l HWIO_QDSS_CTI0_ITCHOUTACK_ADDR A:0x6010eec
y.create.l HWIO_QDSS_CTI0_ITTRIGOUTACK_ADDR A:0x6010ef0
y.create.l HWIO_QDSS_CTI0_ITCHIN_ADDR A:0x6010ef4
y.create.l HWIO_QDSS_CTI0_ITTRIGIN_ADDR A:0x6010ef8
y.create.l HWIO_QDSS_CTI0_ITCTRL_ADDR A:0x6010f00
y.create.l HWIO_QDSS_CTI0_CLAIMSET_ADDR A:0x6010fa0
y.create.l HWIO_QDSS_CTI0_CLAIMCLR_ADDR A:0x6010fa4
y.create.l HWIO_QDSS_CTI0_LAR_ADDR A:0x6010fb0
y.create.l HWIO_QDSS_CTI0_LSR_ADDR A:0x6010fb4
y.create.l HWIO_QDSS_CTI0_AUTHSTATUS_ADDR A:0x6010fb8
y.create.l HWIO_QDSS_CTI0_DEVID_ADDR A:0x6010fc8
y.create.l HWIO_QDSS_CTI0_DEVTYPE_ADDR A:0x6010fcc
y.create.l HWIO_QDSS_CTI0_PERIPHID0_ADDR A:0x6010fe0
y.create.l HWIO_QDSS_CTI0_PERIPHID1_ADDR A:0x6010fe4
y.create.l HWIO_QDSS_CTI0_PERIPHID2_ADDR A:0x6010fe8
y.create.l HWIO_QDSS_CTI0_PERIPHID3_ADDR A:0x6010fec
y.create.l HWIO_QDSS_CTI0_PERIPHID4_ADDR A:0x6010fd0
y.create.l HWIO_QDSS_CTI0_PERIPHID5_ADDR A:0x6010fd4
y.create.l HWIO_QDSS_CTI0_PERIPHID6_ADDR A:0x6010fd8
y.create.l HWIO_QDSS_CTI0_PERIPHID7_ADDR A:0x6010fdc
y.create.l HWIO_QDSS_CTI0_COMPID0_ADDR A:0x6010ff0
y.create.l HWIO_QDSS_CTI0_COMPID1_ADDR A:0x6010ff4
y.create.l HWIO_QDSS_CTI0_COMPID2_ADDR A:0x6010ff8
y.create.l HWIO_QDSS_CTI0_COMPID3_ADDR A:0x6010ffc
y.create.l HWIO_QDSS_CTI1_CTICONTROL_ADDR A:0x6011000
y.create.l HWIO_QDSS_CTI1_CTIINTACK_ADDR A:0x6011010
y.create.l HWIO_QDSS_CTI1_CTIAPPSET_ADDR A:0x6011014
y.create.l HWIO_QDSS_CTI1_CTIAPPCLEAR_ADDR A:0x6011018
y.create.l HWIO_QDSS_CTI1_CTIAPPPULSE_ADDR A:0x601101c
y.create.l HWIO_QDSS_CTI1_CTIINEN0_ADDR A:0x6011020
y.create.l HWIO_QDSS_CTI1_CTIINEN1_ADDR A:0x6011024
y.create.l HWIO_QDSS_CTI1_CTIINEN2_ADDR A:0x6011028
y.create.l HWIO_QDSS_CTI1_CTIINEN3_ADDR A:0x601102c
y.create.l HWIO_QDSS_CTI1_CTIINEN4_ADDR A:0x6011030
y.create.l HWIO_QDSS_CTI1_CTIINEN5_ADDR A:0x6011034
y.create.l HWIO_QDSS_CTI1_CTIINEN6_ADDR A:0x6011038
y.create.l HWIO_QDSS_CTI1_CTIINEN7_ADDR A:0x601103c
y.create.l HWIO_QDSS_CTI1_CTIOUTEN0_ADDR A:0x60110a0
y.create.l HWIO_QDSS_CTI1_CTIOUTEN1_ADDR A:0x60110a4
y.create.l HWIO_QDSS_CTI1_CTIOUTEN2_ADDR A:0x60110a8
y.create.l HWIO_QDSS_CTI1_CTIOUTEN3_ADDR A:0x60110ac
y.create.l HWIO_QDSS_CTI1_CTIOUTEN4_ADDR A:0x60110b0
y.create.l HWIO_QDSS_CTI1_CTIOUTEN5_ADDR A:0x60110b4
y.create.l HWIO_QDSS_CTI1_CTIOUTEN6_ADDR A:0x60110b8
y.create.l HWIO_QDSS_CTI1_CTIOUTEN7_ADDR A:0x60110bc
y.create.l HWIO_QDSS_CTI1_CTITRIGINSTATUS_ADDR A:0x6011130
y.create.l HWIO_QDSS_CTI1_CTITRIGOUTSTATUS_ADDR A:0x6011134
y.create.l HWIO_QDSS_CTI1_CTICHINSTATUS_ADDR A:0x6011138
y.create.l HWIO_QDSS_CTI1_CTICHOUTSTATUS_ADDR A:0x601113c
y.create.l HWIO_QDSS_CTI1_CTIGATE_ADDR A:0x6011140
y.create.l HWIO_QDSS_CTI1_ASICCTL_ADDR A:0x6011144
y.create.l HWIO_QDSS_CTI1_ITCHINACK_ADDR A:0x6011edc
y.create.l HWIO_QDSS_CTI1_ITTRIGINACK_ADDR A:0x6011ee0
y.create.l HWIO_QDSS_CTI1_ITCHOUT_ADDR A:0x6011ee4
y.create.l HWIO_QDSS_CTI1_ITTRIGOUT_ADDR A:0x6011ee8
y.create.l HWIO_QDSS_CTI1_ITCHOUTACK_ADDR A:0x6011eec
y.create.l HWIO_QDSS_CTI1_ITTRIGOUTACK_ADDR A:0x6011ef0
y.create.l HWIO_QDSS_CTI1_ITCHIN_ADDR A:0x6011ef4
y.create.l HWIO_QDSS_CTI1_ITTRIGIN_ADDR A:0x6011ef8
y.create.l HWIO_QDSS_CTI1_ITCTRL_ADDR A:0x6011f00
y.create.l HWIO_QDSS_CTI1_CLAIMSET_ADDR A:0x6011fa0
y.create.l HWIO_QDSS_CTI1_CLAIMCLR_ADDR A:0x6011fa4
y.create.l HWIO_QDSS_CTI1_LAR_ADDR A:0x6011fb0
y.create.l HWIO_QDSS_CTI1_LSR_ADDR A:0x6011fb4
y.create.l HWIO_QDSS_CTI1_AUTHSTATUS_ADDR A:0x6011fb8
y.create.l HWIO_QDSS_CTI1_DEVID_ADDR A:0x6011fc8
y.create.l HWIO_QDSS_CTI1_DEVTYPE_ADDR A:0x6011fcc
y.create.l HWIO_QDSS_CTI1_PERIPHID0_ADDR A:0x6011fe0
y.create.l HWIO_QDSS_CTI1_PERIPHID1_ADDR A:0x6011fe4
y.create.l HWIO_QDSS_CTI1_PERIPHID2_ADDR A:0x6011fe8
y.create.l HWIO_QDSS_CTI1_PERIPHID3_ADDR A:0x6011fec
y.create.l HWIO_QDSS_CTI1_PERIPHID4_ADDR A:0x6011fd0
y.create.l HWIO_QDSS_CTI1_PERIPHID5_ADDR A:0x6011fd4
y.create.l HWIO_QDSS_CTI1_PERIPHID6_ADDR A:0x6011fd8
y.create.l HWIO_QDSS_CTI1_PERIPHID7_ADDR A:0x6011fdc
y.create.l HWIO_QDSS_CTI1_COMPID0_ADDR A:0x6011ff0
y.create.l HWIO_QDSS_CTI1_COMPID1_ADDR A:0x6011ff4
y.create.l HWIO_QDSS_CTI1_COMPID2_ADDR A:0x6011ff8
y.create.l HWIO_QDSS_CTI1_COMPID3_ADDR A:0x6011ffc
y.create.l HWIO_QDSS_CTI2_CTICONTROL_ADDR A:0x6012000
y.create.l HWIO_QDSS_CTI2_CTIINTACK_ADDR A:0x6012010
y.create.l HWIO_QDSS_CTI2_CTIAPPSET_ADDR A:0x6012014
y.create.l HWIO_QDSS_CTI2_CTIAPPCLEAR_ADDR A:0x6012018
y.create.l HWIO_QDSS_CTI2_CTIAPPPULSE_ADDR A:0x601201c
y.create.l HWIO_QDSS_CTI2_CTIINEN0_ADDR A:0x6012020
y.create.l HWIO_QDSS_CTI2_CTIINEN1_ADDR A:0x6012024
y.create.l HWIO_QDSS_CTI2_CTIINEN2_ADDR A:0x6012028
y.create.l HWIO_QDSS_CTI2_CTIINEN3_ADDR A:0x601202c
y.create.l HWIO_QDSS_CTI2_CTIINEN4_ADDR A:0x6012030
y.create.l HWIO_QDSS_CTI2_CTIINEN5_ADDR A:0x6012034
y.create.l HWIO_QDSS_CTI2_CTIINEN6_ADDR A:0x6012038
y.create.l HWIO_QDSS_CTI2_CTIINEN7_ADDR A:0x601203c
y.create.l HWIO_QDSS_CTI2_CTIOUTEN0_ADDR A:0x60120a0
y.create.l HWIO_QDSS_CTI2_CTIOUTEN1_ADDR A:0x60120a4
y.create.l HWIO_QDSS_CTI2_CTIOUTEN2_ADDR A:0x60120a8
y.create.l HWIO_QDSS_CTI2_CTIOUTEN3_ADDR A:0x60120ac
y.create.l HWIO_QDSS_CTI2_CTIOUTEN4_ADDR A:0x60120b0
y.create.l HWIO_QDSS_CTI2_CTIOUTEN5_ADDR A:0x60120b4
y.create.l HWIO_QDSS_CTI2_CTIOUTEN6_ADDR A:0x60120b8
y.create.l HWIO_QDSS_CTI2_CTIOUTEN7_ADDR A:0x60120bc
y.create.l HWIO_QDSS_CTI2_CTITRIGINSTATUS_ADDR A:0x6012130
y.create.l HWIO_QDSS_CTI2_CTITRIGOUTSTATUS_ADDR A:0x6012134
y.create.l HWIO_QDSS_CTI2_CTICHINSTATUS_ADDR A:0x6012138
y.create.l HWIO_QDSS_CTI2_CTICHOUTSTATUS_ADDR A:0x601213c
y.create.l HWIO_QDSS_CTI2_CTIGATE_ADDR A:0x6012140
y.create.l HWIO_QDSS_CTI2_ASICCTL_ADDR A:0x6012144
y.create.l HWIO_QDSS_CTI2_ITCHINACK_ADDR A:0x6012edc
y.create.l HWIO_QDSS_CTI2_ITTRIGINACK_ADDR A:0x6012ee0
y.create.l HWIO_QDSS_CTI2_ITCHOUT_ADDR A:0x6012ee4
y.create.l HWIO_QDSS_CTI2_ITTRIGOUT_ADDR A:0x6012ee8
y.create.l HWIO_QDSS_CTI2_ITCHOUTACK_ADDR A:0x6012eec
y.create.l HWIO_QDSS_CTI2_ITTRIGOUTACK_ADDR A:0x6012ef0
y.create.l HWIO_QDSS_CTI2_ITCHIN_ADDR A:0x6012ef4
y.create.l HWIO_QDSS_CTI2_ITTRIGIN_ADDR A:0x6012ef8
y.create.l HWIO_QDSS_CTI2_ITCTRL_ADDR A:0x6012f00
y.create.l HWIO_QDSS_CTI2_CLAIMSET_ADDR A:0x6012fa0
y.create.l HWIO_QDSS_CTI2_CLAIMCLR_ADDR A:0x6012fa4
y.create.l HWIO_QDSS_CTI2_LAR_ADDR A:0x6012fb0
y.create.l HWIO_QDSS_CTI2_LSR_ADDR A:0x6012fb4
y.create.l HWIO_QDSS_CTI2_AUTHSTATUS_ADDR A:0x6012fb8
y.create.l HWIO_QDSS_CTI2_DEVID_ADDR A:0x6012fc8
y.create.l HWIO_QDSS_CTI2_DEVTYPE_ADDR A:0x6012fcc
y.create.l HWIO_QDSS_CTI2_PERIPHID0_ADDR A:0x6012fe0
y.create.l HWIO_QDSS_CTI2_PERIPHID1_ADDR A:0x6012fe4
y.create.l HWIO_QDSS_CTI2_PERIPHID2_ADDR A:0x6012fe8
y.create.l HWIO_QDSS_CTI2_PERIPHID3_ADDR A:0x6012fec
y.create.l HWIO_QDSS_CTI2_PERIPHID4_ADDR A:0x6012fd0
y.create.l HWIO_QDSS_CTI2_PERIPHID5_ADDR A:0x6012fd4
y.create.l HWIO_QDSS_CTI2_PERIPHID6_ADDR A:0x6012fd8
y.create.l HWIO_QDSS_CTI2_PERIPHID7_ADDR A:0x6012fdc
y.create.l HWIO_QDSS_CTI2_COMPID0_ADDR A:0x6012ff0
y.create.l HWIO_QDSS_CTI2_COMPID1_ADDR A:0x6012ff4
y.create.l HWIO_QDSS_CTI2_COMPID2_ADDR A:0x6012ff8
y.create.l HWIO_QDSS_CTI2_COMPID3_ADDR A:0x6012ffc
y.create.l HWIO_QDSS_CTI3_CTICONTROL_ADDR A:0x6013000
y.create.l HWIO_QDSS_CTI3_CTIINTACK_ADDR A:0x6013010
y.create.l HWIO_QDSS_CTI3_CTIAPPSET_ADDR A:0x6013014
y.create.l HWIO_QDSS_CTI3_CTIAPPCLEAR_ADDR A:0x6013018
y.create.l HWIO_QDSS_CTI3_CTIAPPPULSE_ADDR A:0x601301c
y.create.l HWIO_QDSS_CTI3_CTIINEN0_ADDR A:0x6013020
y.create.l HWIO_QDSS_CTI3_CTIINEN1_ADDR A:0x6013024
y.create.l HWIO_QDSS_CTI3_CTIINEN2_ADDR A:0x6013028
y.create.l HWIO_QDSS_CTI3_CTIINEN3_ADDR A:0x601302c
y.create.l HWIO_QDSS_CTI3_CTIINEN4_ADDR A:0x6013030
y.create.l HWIO_QDSS_CTI3_CTIINEN5_ADDR A:0x6013034
y.create.l HWIO_QDSS_CTI3_CTIINEN6_ADDR A:0x6013038
y.create.l HWIO_QDSS_CTI3_CTIINEN7_ADDR A:0x601303c
y.create.l HWIO_QDSS_CTI3_CTIOUTEN0_ADDR A:0x60130a0
y.create.l HWIO_QDSS_CTI3_CTIOUTEN1_ADDR A:0x60130a4
y.create.l HWIO_QDSS_CTI3_CTIOUTEN2_ADDR A:0x60130a8
y.create.l HWIO_QDSS_CTI3_CTIOUTEN3_ADDR A:0x60130ac
y.create.l HWIO_QDSS_CTI3_CTIOUTEN4_ADDR A:0x60130b0
y.create.l HWIO_QDSS_CTI3_CTIOUTEN5_ADDR A:0x60130b4
y.create.l HWIO_QDSS_CTI3_CTIOUTEN6_ADDR A:0x60130b8
y.create.l HWIO_QDSS_CTI3_CTIOUTEN7_ADDR A:0x60130bc
y.create.l HWIO_QDSS_CTI3_CTITRIGINSTATUS_ADDR A:0x6013130
y.create.l HWIO_QDSS_CTI3_CTITRIGOUTSTATUS_ADDR A:0x6013134
y.create.l HWIO_QDSS_CTI3_CTICHINSTATUS_ADDR A:0x6013138
y.create.l HWIO_QDSS_CTI3_CTICHOUTSTATUS_ADDR A:0x601313c
y.create.l HWIO_QDSS_CTI3_CTIGATE_ADDR A:0x6013140
y.create.l HWIO_QDSS_CTI3_ASICCTL_ADDR A:0x6013144
y.create.l HWIO_QDSS_CTI3_ITCHINACK_ADDR A:0x6013edc
y.create.l HWIO_QDSS_CTI3_ITTRIGINACK_ADDR A:0x6013ee0
y.create.l HWIO_QDSS_CTI3_ITCHOUT_ADDR A:0x6013ee4
y.create.l HWIO_QDSS_CTI3_ITTRIGOUT_ADDR A:0x6013ee8
y.create.l HWIO_QDSS_CTI3_ITCHOUTACK_ADDR A:0x6013eec
y.create.l HWIO_QDSS_CTI3_ITTRIGOUTACK_ADDR A:0x6013ef0
y.create.l HWIO_QDSS_CTI3_ITCHIN_ADDR A:0x6013ef4
y.create.l HWIO_QDSS_CTI3_ITTRIGIN_ADDR A:0x6013ef8
y.create.l HWIO_QDSS_CTI3_ITCTRL_ADDR A:0x6013f00
y.create.l HWIO_QDSS_CTI3_CLAIMSET_ADDR A:0x6013fa0
y.create.l HWIO_QDSS_CTI3_CLAIMCLR_ADDR A:0x6013fa4
y.create.l HWIO_QDSS_CTI3_LAR_ADDR A:0x6013fb0
y.create.l HWIO_QDSS_CTI3_LSR_ADDR A:0x6013fb4
y.create.l HWIO_QDSS_CTI3_AUTHSTATUS_ADDR A:0x6013fb8
y.create.l HWIO_QDSS_CTI3_DEVID_ADDR A:0x6013fc8
y.create.l HWIO_QDSS_CTI3_DEVTYPE_ADDR A:0x6013fcc
y.create.l HWIO_QDSS_CTI3_PERIPHID0_ADDR A:0x6013fe0
y.create.l HWIO_QDSS_CTI3_PERIPHID1_ADDR A:0x6013fe4
y.create.l HWIO_QDSS_CTI3_PERIPHID2_ADDR A:0x6013fe8
y.create.l HWIO_QDSS_CTI3_PERIPHID3_ADDR A:0x6013fec
y.create.l HWIO_QDSS_CTI3_PERIPHID4_ADDR A:0x6013fd0
y.create.l HWIO_QDSS_CTI3_PERIPHID5_ADDR A:0x6013fd4
y.create.l HWIO_QDSS_CTI3_PERIPHID6_ADDR A:0x6013fd8
y.create.l HWIO_QDSS_CTI3_PERIPHID7_ADDR A:0x6013fdc
y.create.l HWIO_QDSS_CTI3_COMPID0_ADDR A:0x6013ff0
y.create.l HWIO_QDSS_CTI3_COMPID1_ADDR A:0x6013ff4
y.create.l HWIO_QDSS_CTI3_COMPID2_ADDR A:0x6013ff8
y.create.l HWIO_QDSS_CTI3_COMPID3_ADDR A:0x6013ffc
y.create.l HWIO_QDSS_CTI4_CTICONTROL_ADDR A:0x6014000
y.create.l HWIO_QDSS_CTI4_CTIINTACK_ADDR A:0x6014010
y.create.l HWIO_QDSS_CTI4_CTIAPPSET_ADDR A:0x6014014
y.create.l HWIO_QDSS_CTI4_CTIAPPCLEAR_ADDR A:0x6014018
y.create.l HWIO_QDSS_CTI4_CTIAPPPULSE_ADDR A:0x601401c
y.create.l HWIO_QDSS_CTI4_CTIINEN0_ADDR A:0x6014020
y.create.l HWIO_QDSS_CTI4_CTIINEN1_ADDR A:0x6014024
y.create.l HWIO_QDSS_CTI4_CTIINEN2_ADDR A:0x6014028
y.create.l HWIO_QDSS_CTI4_CTIINEN3_ADDR A:0x601402c
y.create.l HWIO_QDSS_CTI4_CTIINEN4_ADDR A:0x6014030
y.create.l HWIO_QDSS_CTI4_CTIINEN5_ADDR A:0x6014034
y.create.l HWIO_QDSS_CTI4_CTIINEN6_ADDR A:0x6014038
y.create.l HWIO_QDSS_CTI4_CTIINEN7_ADDR A:0x601403c
y.create.l HWIO_QDSS_CTI4_CTIOUTEN0_ADDR A:0x60140a0
y.create.l HWIO_QDSS_CTI4_CTIOUTEN1_ADDR A:0x60140a4
y.create.l HWIO_QDSS_CTI4_CTIOUTEN2_ADDR A:0x60140a8
y.create.l HWIO_QDSS_CTI4_CTIOUTEN3_ADDR A:0x60140ac
y.create.l HWIO_QDSS_CTI4_CTIOUTEN4_ADDR A:0x60140b0
y.create.l HWIO_QDSS_CTI4_CTIOUTEN5_ADDR A:0x60140b4
y.create.l HWIO_QDSS_CTI4_CTIOUTEN6_ADDR A:0x60140b8
y.create.l HWIO_QDSS_CTI4_CTIOUTEN7_ADDR A:0x60140bc
y.create.l HWIO_QDSS_CTI4_CTITRIGINSTATUS_ADDR A:0x6014130
y.create.l HWIO_QDSS_CTI4_CTITRIGOUTSTATUS_ADDR A:0x6014134
y.create.l HWIO_QDSS_CTI4_CTICHINSTATUS_ADDR A:0x6014138
y.create.l HWIO_QDSS_CTI4_CTICHOUTSTATUS_ADDR A:0x601413c
y.create.l HWIO_QDSS_CTI4_CTIGATE_ADDR A:0x6014140
y.create.l HWIO_QDSS_CTI4_ASICCTL_ADDR A:0x6014144
y.create.l HWIO_QDSS_CTI4_ITCHINACK_ADDR A:0x6014edc
y.create.l HWIO_QDSS_CTI4_ITTRIGINACK_ADDR A:0x6014ee0
y.create.l HWIO_QDSS_CTI4_ITCHOUT_ADDR A:0x6014ee4
y.create.l HWIO_QDSS_CTI4_ITTRIGOUT_ADDR A:0x6014ee8
y.create.l HWIO_QDSS_CTI4_ITCHOUTACK_ADDR A:0x6014eec
y.create.l HWIO_QDSS_CTI4_ITTRIGOUTACK_ADDR A:0x6014ef0
y.create.l HWIO_QDSS_CTI4_ITCHIN_ADDR A:0x6014ef4
y.create.l HWIO_QDSS_CTI4_ITTRIGIN_ADDR A:0x6014ef8
y.create.l HWIO_QDSS_CTI4_ITCTRL_ADDR A:0x6014f00
y.create.l HWIO_QDSS_CTI4_CLAIMSET_ADDR A:0x6014fa0
y.create.l HWIO_QDSS_CTI4_CLAIMCLR_ADDR A:0x6014fa4
y.create.l HWIO_QDSS_CTI4_LAR_ADDR A:0x6014fb0
y.create.l HWIO_QDSS_CTI4_LSR_ADDR A:0x6014fb4
y.create.l HWIO_QDSS_CTI4_AUTHSTATUS_ADDR A:0x6014fb8
y.create.l HWIO_QDSS_CTI4_DEVID_ADDR A:0x6014fc8
y.create.l HWIO_QDSS_CTI4_DEVTYPE_ADDR A:0x6014fcc
y.create.l HWIO_QDSS_CTI4_PERIPHID0_ADDR A:0x6014fe0
y.create.l HWIO_QDSS_CTI4_PERIPHID1_ADDR A:0x6014fe4
y.create.l HWIO_QDSS_CTI4_PERIPHID2_ADDR A:0x6014fe8
y.create.l HWIO_QDSS_CTI4_PERIPHID3_ADDR A:0x6014fec
y.create.l HWIO_QDSS_CTI4_PERIPHID4_ADDR A:0x6014fd0
y.create.l HWIO_QDSS_CTI4_PERIPHID5_ADDR A:0x6014fd4
y.create.l HWIO_QDSS_CTI4_PERIPHID6_ADDR A:0x6014fd8
y.create.l HWIO_QDSS_CTI4_PERIPHID7_ADDR A:0x6014fdc
y.create.l HWIO_QDSS_CTI4_COMPID0_ADDR A:0x6014ff0
y.create.l HWIO_QDSS_CTI4_COMPID1_ADDR A:0x6014ff4
y.create.l HWIO_QDSS_CTI4_COMPID2_ADDR A:0x6014ff8
y.create.l HWIO_QDSS_CTI4_COMPID3_ADDR A:0x6014ffc
y.create.l HWIO_QDSS_CTI5_CTICONTROL_ADDR A:0x6015000
y.create.l HWIO_QDSS_CTI5_CTIINTACK_ADDR A:0x6015010
y.create.l HWIO_QDSS_CTI5_CTIAPPSET_ADDR A:0x6015014
y.create.l HWIO_QDSS_CTI5_CTIAPPCLEAR_ADDR A:0x6015018
y.create.l HWIO_QDSS_CTI5_CTIAPPPULSE_ADDR A:0x601501c
y.create.l HWIO_QDSS_CTI5_CTIINEN0_ADDR A:0x6015020
y.create.l HWIO_QDSS_CTI5_CTIINEN1_ADDR A:0x6015024
y.create.l HWIO_QDSS_CTI5_CTIINEN2_ADDR A:0x6015028
y.create.l HWIO_QDSS_CTI5_CTIINEN3_ADDR A:0x601502c
y.create.l HWIO_QDSS_CTI5_CTIINEN4_ADDR A:0x6015030
y.create.l HWIO_QDSS_CTI5_CTIINEN5_ADDR A:0x6015034
y.create.l HWIO_QDSS_CTI5_CTIINEN6_ADDR A:0x6015038
y.create.l HWIO_QDSS_CTI5_CTIINEN7_ADDR A:0x601503c
y.create.l HWIO_QDSS_CTI5_CTIOUTEN0_ADDR A:0x60150a0
y.create.l HWIO_QDSS_CTI5_CTIOUTEN1_ADDR A:0x60150a4
y.create.l HWIO_QDSS_CTI5_CTIOUTEN2_ADDR A:0x60150a8
y.create.l HWIO_QDSS_CTI5_CTIOUTEN3_ADDR A:0x60150ac
y.create.l HWIO_QDSS_CTI5_CTIOUTEN4_ADDR A:0x60150b0
y.create.l HWIO_QDSS_CTI5_CTIOUTEN5_ADDR A:0x60150b4
y.create.l HWIO_QDSS_CTI5_CTIOUTEN6_ADDR A:0x60150b8
y.create.l HWIO_QDSS_CTI5_CTIOUTEN7_ADDR A:0x60150bc
y.create.l HWIO_QDSS_CTI5_CTITRIGINSTATUS_ADDR A:0x6015130
y.create.l HWIO_QDSS_CTI5_CTITRIGOUTSTATUS_ADDR A:0x6015134
y.create.l HWIO_QDSS_CTI5_CTICHINSTATUS_ADDR A:0x6015138
y.create.l HWIO_QDSS_CTI5_CTICHOUTSTATUS_ADDR A:0x601513c
y.create.l HWIO_QDSS_CTI5_CTIGATE_ADDR A:0x6015140
y.create.l HWIO_QDSS_CTI5_ASICCTL_ADDR A:0x6015144
y.create.l HWIO_QDSS_CTI5_ITCHINACK_ADDR A:0x6015edc
y.create.l HWIO_QDSS_CTI5_ITTRIGINACK_ADDR A:0x6015ee0
y.create.l HWIO_QDSS_CTI5_ITCHOUT_ADDR A:0x6015ee4
y.create.l HWIO_QDSS_CTI5_ITTRIGOUT_ADDR A:0x6015ee8
y.create.l HWIO_QDSS_CTI5_ITCHOUTACK_ADDR A:0x6015eec
y.create.l HWIO_QDSS_CTI5_ITTRIGOUTACK_ADDR A:0x6015ef0
y.create.l HWIO_QDSS_CTI5_ITCHIN_ADDR A:0x6015ef4
y.create.l HWIO_QDSS_CTI5_ITTRIGIN_ADDR A:0x6015ef8
y.create.l HWIO_QDSS_CTI5_ITCTRL_ADDR A:0x6015f00
y.create.l HWIO_QDSS_CTI5_CLAIMSET_ADDR A:0x6015fa0
y.create.l HWIO_QDSS_CTI5_CLAIMCLR_ADDR A:0x6015fa4
y.create.l HWIO_QDSS_CTI5_LAR_ADDR A:0x6015fb0
y.create.l HWIO_QDSS_CTI5_LSR_ADDR A:0x6015fb4
y.create.l HWIO_QDSS_CTI5_AUTHSTATUS_ADDR A:0x6015fb8
y.create.l HWIO_QDSS_CTI5_DEVID_ADDR A:0x6015fc8
y.create.l HWIO_QDSS_CTI5_DEVTYPE_ADDR A:0x6015fcc
y.create.l HWIO_QDSS_CTI5_PERIPHID0_ADDR A:0x6015fe0
y.create.l HWIO_QDSS_CTI5_PERIPHID1_ADDR A:0x6015fe4
y.create.l HWIO_QDSS_CTI5_PERIPHID2_ADDR A:0x6015fe8
y.create.l HWIO_QDSS_CTI5_PERIPHID3_ADDR A:0x6015fec
y.create.l HWIO_QDSS_CTI5_PERIPHID4_ADDR A:0x6015fd0
y.create.l HWIO_QDSS_CTI5_PERIPHID5_ADDR A:0x6015fd4
y.create.l HWIO_QDSS_CTI5_PERIPHID6_ADDR A:0x6015fd8
y.create.l HWIO_QDSS_CTI5_PERIPHID7_ADDR A:0x6015fdc
y.create.l HWIO_QDSS_CTI5_COMPID0_ADDR A:0x6015ff0
y.create.l HWIO_QDSS_CTI5_COMPID1_ADDR A:0x6015ff4
y.create.l HWIO_QDSS_CTI5_COMPID2_ADDR A:0x6015ff8
y.create.l HWIO_QDSS_CTI5_COMPID3_ADDR A:0x6015ffc
y.create.l HWIO_QDSS_CTI6_CTICONTROL_ADDR A:0x6016000
y.create.l HWIO_QDSS_CTI6_CTIINTACK_ADDR A:0x6016010
y.create.l HWIO_QDSS_CTI6_CTIAPPSET_ADDR A:0x6016014
y.create.l HWIO_QDSS_CTI6_CTIAPPCLEAR_ADDR A:0x6016018
y.create.l HWIO_QDSS_CTI6_CTIAPPPULSE_ADDR A:0x601601c
y.create.l HWIO_QDSS_CTI6_CTIINEN0_ADDR A:0x6016020
y.create.l HWIO_QDSS_CTI6_CTIINEN1_ADDR A:0x6016024
y.create.l HWIO_QDSS_CTI6_CTIINEN2_ADDR A:0x6016028
y.create.l HWIO_QDSS_CTI6_CTIINEN3_ADDR A:0x601602c
y.create.l HWIO_QDSS_CTI6_CTIINEN4_ADDR A:0x6016030
y.create.l HWIO_QDSS_CTI6_CTIINEN5_ADDR A:0x6016034
y.create.l HWIO_QDSS_CTI6_CTIINEN6_ADDR A:0x6016038
y.create.l HWIO_QDSS_CTI6_CTIINEN7_ADDR A:0x601603c
y.create.l HWIO_QDSS_CTI6_CTIOUTEN0_ADDR A:0x60160a0
y.create.l HWIO_QDSS_CTI6_CTIOUTEN1_ADDR A:0x60160a4
y.create.l HWIO_QDSS_CTI6_CTIOUTEN2_ADDR A:0x60160a8
y.create.l HWIO_QDSS_CTI6_CTIOUTEN3_ADDR A:0x60160ac
y.create.l HWIO_QDSS_CTI6_CTIOUTEN4_ADDR A:0x60160b0
y.create.l HWIO_QDSS_CTI6_CTIOUTEN5_ADDR A:0x60160b4
y.create.l HWIO_QDSS_CTI6_CTIOUTEN6_ADDR A:0x60160b8
y.create.l HWIO_QDSS_CTI6_CTIOUTEN7_ADDR A:0x60160bc
y.create.l HWIO_QDSS_CTI6_CTITRIGINSTATUS_ADDR A:0x6016130
y.create.l HWIO_QDSS_CTI6_CTITRIGOUTSTATUS_ADDR A:0x6016134
y.create.l HWIO_QDSS_CTI6_CTICHINSTATUS_ADDR A:0x6016138
y.create.l HWIO_QDSS_CTI6_CTICHOUTSTATUS_ADDR A:0x601613c
y.create.l HWIO_QDSS_CTI6_CTIGATE_ADDR A:0x6016140
y.create.l HWIO_QDSS_CTI6_ASICCTL_ADDR A:0x6016144
y.create.l HWIO_QDSS_CTI6_ITCHINACK_ADDR A:0x6016edc
y.create.l HWIO_QDSS_CTI6_ITTRIGINACK_ADDR A:0x6016ee0
y.create.l HWIO_QDSS_CTI6_ITCHOUT_ADDR A:0x6016ee4
y.create.l HWIO_QDSS_CTI6_ITTRIGOUT_ADDR A:0x6016ee8
y.create.l HWIO_QDSS_CTI6_ITCHOUTACK_ADDR A:0x6016eec
y.create.l HWIO_QDSS_CTI6_ITTRIGOUTACK_ADDR A:0x6016ef0
y.create.l HWIO_QDSS_CTI6_ITCHIN_ADDR A:0x6016ef4
y.create.l HWIO_QDSS_CTI6_ITTRIGIN_ADDR A:0x6016ef8
y.create.l HWIO_QDSS_CTI6_ITCTRL_ADDR A:0x6016f00
y.create.l HWIO_QDSS_CTI6_CLAIMSET_ADDR A:0x6016fa0
y.create.l HWIO_QDSS_CTI6_CLAIMCLR_ADDR A:0x6016fa4
y.create.l HWIO_QDSS_CTI6_LAR_ADDR A:0x6016fb0
y.create.l HWIO_QDSS_CTI6_LSR_ADDR A:0x6016fb4
y.create.l HWIO_QDSS_CTI6_AUTHSTATUS_ADDR A:0x6016fb8
y.create.l HWIO_QDSS_CTI6_DEVID_ADDR A:0x6016fc8
y.create.l HWIO_QDSS_CTI6_DEVTYPE_ADDR A:0x6016fcc
y.create.l HWIO_QDSS_CTI6_PERIPHID0_ADDR A:0x6016fe0
y.create.l HWIO_QDSS_CTI6_PERIPHID1_ADDR A:0x6016fe4
y.create.l HWIO_QDSS_CTI6_PERIPHID2_ADDR A:0x6016fe8
y.create.l HWIO_QDSS_CTI6_PERIPHID3_ADDR A:0x6016fec
y.create.l HWIO_QDSS_CTI6_PERIPHID4_ADDR A:0x6016fd0
y.create.l HWIO_QDSS_CTI6_PERIPHID5_ADDR A:0x6016fd4
y.create.l HWIO_QDSS_CTI6_PERIPHID6_ADDR A:0x6016fd8
y.create.l HWIO_QDSS_CTI6_PERIPHID7_ADDR A:0x6016fdc
y.create.l HWIO_QDSS_CTI6_COMPID0_ADDR A:0x6016ff0
y.create.l HWIO_QDSS_CTI6_COMPID1_ADDR A:0x6016ff4
y.create.l HWIO_QDSS_CTI6_COMPID2_ADDR A:0x6016ff8
y.create.l HWIO_QDSS_CTI6_COMPID3_ADDR A:0x6016ffc
y.create.l HWIO_QDSS_CTI7_CTICONTROL_ADDR A:0x6017000
y.create.l HWIO_QDSS_CTI7_CTIINTACK_ADDR A:0x6017010
y.create.l HWIO_QDSS_CTI7_CTIAPPSET_ADDR A:0x6017014
y.create.l HWIO_QDSS_CTI7_CTIAPPCLEAR_ADDR A:0x6017018
y.create.l HWIO_QDSS_CTI7_CTIAPPPULSE_ADDR A:0x601701c
y.create.l HWIO_QDSS_CTI7_CTIINEN0_ADDR A:0x6017020
y.create.l HWIO_QDSS_CTI7_CTIINEN1_ADDR A:0x6017024
y.create.l HWIO_QDSS_CTI7_CTIINEN2_ADDR A:0x6017028
y.create.l HWIO_QDSS_CTI7_CTIINEN3_ADDR A:0x601702c
y.create.l HWIO_QDSS_CTI7_CTIINEN4_ADDR A:0x6017030
y.create.l HWIO_QDSS_CTI7_CTIINEN5_ADDR A:0x6017034
y.create.l HWIO_QDSS_CTI7_CTIINEN6_ADDR A:0x6017038
y.create.l HWIO_QDSS_CTI7_CTIINEN7_ADDR A:0x601703c
y.create.l HWIO_QDSS_CTI7_CTIOUTEN0_ADDR A:0x60170a0
y.create.l HWIO_QDSS_CTI7_CTIOUTEN1_ADDR A:0x60170a4
y.create.l HWIO_QDSS_CTI7_CTIOUTEN2_ADDR A:0x60170a8
y.create.l HWIO_QDSS_CTI7_CTIOUTEN3_ADDR A:0x60170ac
y.create.l HWIO_QDSS_CTI7_CTIOUTEN4_ADDR A:0x60170b0
y.create.l HWIO_QDSS_CTI7_CTIOUTEN5_ADDR A:0x60170b4
y.create.l HWIO_QDSS_CTI7_CTIOUTEN6_ADDR A:0x60170b8
y.create.l HWIO_QDSS_CTI7_CTIOUTEN7_ADDR A:0x60170bc
y.create.l HWIO_QDSS_CTI7_CTITRIGINSTATUS_ADDR A:0x6017130
y.create.l HWIO_QDSS_CTI7_CTITRIGOUTSTATUS_ADDR A:0x6017134
y.create.l HWIO_QDSS_CTI7_CTICHINSTATUS_ADDR A:0x6017138
y.create.l HWIO_QDSS_CTI7_CTICHOUTSTATUS_ADDR A:0x601713c
y.create.l HWIO_QDSS_CTI7_CTIGATE_ADDR A:0x6017140
y.create.l HWIO_QDSS_CTI7_ASICCTL_ADDR A:0x6017144
y.create.l HWIO_QDSS_CTI7_ITCHINACK_ADDR A:0x6017edc
y.create.l HWIO_QDSS_CTI7_ITTRIGINACK_ADDR A:0x6017ee0
y.create.l HWIO_QDSS_CTI7_ITCHOUT_ADDR A:0x6017ee4
y.create.l HWIO_QDSS_CTI7_ITTRIGOUT_ADDR A:0x6017ee8
y.create.l HWIO_QDSS_CTI7_ITCHOUTACK_ADDR A:0x6017eec
y.create.l HWIO_QDSS_CTI7_ITTRIGOUTACK_ADDR A:0x6017ef0
y.create.l HWIO_QDSS_CTI7_ITCHIN_ADDR A:0x6017ef4
y.create.l HWIO_QDSS_CTI7_ITTRIGIN_ADDR A:0x6017ef8
y.create.l HWIO_QDSS_CTI7_ITCTRL_ADDR A:0x6017f00
y.create.l HWIO_QDSS_CTI7_CLAIMSET_ADDR A:0x6017fa0
y.create.l HWIO_QDSS_CTI7_CLAIMCLR_ADDR A:0x6017fa4
y.create.l HWIO_QDSS_CTI7_LAR_ADDR A:0x6017fb0
y.create.l HWIO_QDSS_CTI7_LSR_ADDR A:0x6017fb4
y.create.l HWIO_QDSS_CTI7_AUTHSTATUS_ADDR A:0x6017fb8
y.create.l HWIO_QDSS_CTI7_DEVID_ADDR A:0x6017fc8
y.create.l HWIO_QDSS_CTI7_DEVTYPE_ADDR A:0x6017fcc
y.create.l HWIO_QDSS_CTI7_PERIPHID0_ADDR A:0x6017fe0
y.create.l HWIO_QDSS_CTI7_PERIPHID1_ADDR A:0x6017fe4
y.create.l HWIO_QDSS_CTI7_PERIPHID2_ADDR A:0x6017fe8
y.create.l HWIO_QDSS_CTI7_PERIPHID3_ADDR A:0x6017fec
y.create.l HWIO_QDSS_CTI7_PERIPHID4_ADDR A:0x6017fd0
y.create.l HWIO_QDSS_CTI7_PERIPHID5_ADDR A:0x6017fd4
y.create.l HWIO_QDSS_CTI7_PERIPHID6_ADDR A:0x6017fd8
y.create.l HWIO_QDSS_CTI7_PERIPHID7_ADDR A:0x6017fdc
y.create.l HWIO_QDSS_CTI7_COMPID0_ADDR A:0x6017ff0
y.create.l HWIO_QDSS_CTI7_COMPID1_ADDR A:0x6017ff4
y.create.l HWIO_QDSS_CTI7_COMPID2_ADDR A:0x6017ff8
y.create.l HWIO_QDSS_CTI7_COMPID3_ADDR A:0x6017ffc
y.create.l HWIO_QDSS_CTI8_CTICONTROL_ADDR A:0x6018000
y.create.l HWIO_QDSS_CTI8_CTIINTACK_ADDR A:0x6018010
y.create.l HWIO_QDSS_CTI8_CTIAPPSET_ADDR A:0x6018014
y.create.l HWIO_QDSS_CTI8_CTIAPPCLEAR_ADDR A:0x6018018
y.create.l HWIO_QDSS_CTI8_CTIAPPPULSE_ADDR A:0x601801c
y.create.l HWIO_QDSS_CTI8_CTIINEN0_ADDR A:0x6018020
y.create.l HWIO_QDSS_CTI8_CTIINEN1_ADDR A:0x6018024
y.create.l HWIO_QDSS_CTI8_CTIINEN2_ADDR A:0x6018028
y.create.l HWIO_QDSS_CTI8_CTIINEN3_ADDR A:0x601802c
y.create.l HWIO_QDSS_CTI8_CTIINEN4_ADDR A:0x6018030
y.create.l HWIO_QDSS_CTI8_CTIINEN5_ADDR A:0x6018034
y.create.l HWIO_QDSS_CTI8_CTIINEN6_ADDR A:0x6018038
y.create.l HWIO_QDSS_CTI8_CTIINEN7_ADDR A:0x601803c
y.create.l HWIO_QDSS_CTI8_CTIOUTEN0_ADDR A:0x60180a0
y.create.l HWIO_QDSS_CTI8_CTIOUTEN1_ADDR A:0x60180a4
y.create.l HWIO_QDSS_CTI8_CTIOUTEN2_ADDR A:0x60180a8
y.create.l HWIO_QDSS_CTI8_CTIOUTEN3_ADDR A:0x60180ac
y.create.l HWIO_QDSS_CTI8_CTIOUTEN4_ADDR A:0x60180b0
y.create.l HWIO_QDSS_CTI8_CTIOUTEN5_ADDR A:0x60180b4
y.create.l HWIO_QDSS_CTI8_CTIOUTEN6_ADDR A:0x60180b8
y.create.l HWIO_QDSS_CTI8_CTIOUTEN7_ADDR A:0x60180bc
y.create.l HWIO_QDSS_CTI8_CTITRIGINSTATUS_ADDR A:0x6018130
y.create.l HWIO_QDSS_CTI8_CTITRIGOUTSTATUS_ADDR A:0x6018134
y.create.l HWIO_QDSS_CTI8_CTICHINSTATUS_ADDR A:0x6018138
y.create.l HWIO_QDSS_CTI8_CTICHOUTSTATUS_ADDR A:0x601813c
y.create.l HWIO_QDSS_CTI8_CTIGATE_ADDR A:0x6018140
y.create.l HWIO_QDSS_CTI8_ASICCTL_ADDR A:0x6018144
y.create.l HWIO_QDSS_CTI8_ITCHINACK_ADDR A:0x6018edc
y.create.l HWIO_QDSS_CTI8_ITTRIGINACK_ADDR A:0x6018ee0
y.create.l HWIO_QDSS_CTI8_ITCHOUT_ADDR A:0x6018ee4
y.create.l HWIO_QDSS_CTI8_ITTRIGOUT_ADDR A:0x6018ee8
y.create.l HWIO_QDSS_CTI8_ITCHOUTACK_ADDR A:0x6018eec
y.create.l HWIO_QDSS_CTI8_ITTRIGOUTACK_ADDR A:0x6018ef0
y.create.l HWIO_QDSS_CTI8_ITCHIN_ADDR A:0x6018ef4
y.create.l HWIO_QDSS_CTI8_ITTRIGIN_ADDR A:0x6018ef8
y.create.l HWIO_QDSS_CTI8_ITCTRL_ADDR A:0x6018f00
y.create.l HWIO_QDSS_CTI8_CLAIMSET_ADDR A:0x6018fa0
y.create.l HWIO_QDSS_CTI8_CLAIMCLR_ADDR A:0x6018fa4
y.create.l HWIO_QDSS_CTI8_LAR_ADDR A:0x6018fb0
y.create.l HWIO_QDSS_CTI8_LSR_ADDR A:0x6018fb4
y.create.l HWIO_QDSS_CTI8_AUTHSTATUS_ADDR A:0x6018fb8
y.create.l HWIO_QDSS_CTI8_DEVID_ADDR A:0x6018fc8
y.create.l HWIO_QDSS_CTI8_DEVTYPE_ADDR A:0x6018fcc
y.create.l HWIO_QDSS_CTI8_PERIPHID0_ADDR A:0x6018fe0
y.create.l HWIO_QDSS_CTI8_PERIPHID1_ADDR A:0x6018fe4
y.create.l HWIO_QDSS_CTI8_PERIPHID2_ADDR A:0x6018fe8
y.create.l HWIO_QDSS_CTI8_PERIPHID3_ADDR A:0x6018fec
y.create.l HWIO_QDSS_CTI8_PERIPHID4_ADDR A:0x6018fd0
y.create.l HWIO_QDSS_CTI8_PERIPHID5_ADDR A:0x6018fd4
y.create.l HWIO_QDSS_CTI8_PERIPHID6_ADDR A:0x6018fd8
y.create.l HWIO_QDSS_CTI8_PERIPHID7_ADDR A:0x6018fdc
y.create.l HWIO_QDSS_CTI8_COMPID0_ADDR A:0x6018ff0
y.create.l HWIO_QDSS_CTI8_COMPID1_ADDR A:0x6018ff4
y.create.l HWIO_QDSS_CTI8_COMPID2_ADDR A:0x6018ff8
y.create.l HWIO_QDSS_CTI8_COMPID3_ADDR A:0x6018ffc
y.create.l HWIO_QDSS_CSTPIU_SUPPORTED_PORT_SIZES_ADDR A:0x6020000
y.create.l HWIO_QDSS_CSTPIU_CURRENT_PORT_SIZE_ADDR A:0x6020004
y.create.l HWIO_QDSS_CSTPIU_SUPPORTED_TRIGGER_MODES_ADDR A:0x6020100
y.create.l HWIO_QDSS_CSTPIU_TRIGGER_COUNTER_VALUE_ADDR A:0x6020104
y.create.l HWIO_QDSS_CSTPIU_TRIGGER_MULTIPLIER_ADDR A:0x6020108
y.create.l HWIO_QDSS_CSTPIU_SUPPORTED_TEST_PATTERN_MODES_ADDR A:0x6020200
y.create.l HWIO_QDSS_CSTPIU_CURRENT_TEST_PATTERN_MODE_ADDR A:0x6020204
y.create.l HWIO_QDSS_CSTPIU_TPRCR_ADDR A:0x6020208
y.create.l HWIO_QDSS_CSTPIU_FFSR_ADDR A:0x6020300
y.create.l HWIO_QDSS_CSTPIU_FFCR_ADDR A:0x6020304
y.create.l HWIO_QDSS_CSTPIU_FSCR_ADDR A:0x6020308
y.create.l HWIO_QDSS_CSTPIU_EXTCTL_IN_PORT_ADDR A:0x6020400
y.create.l HWIO_QDSS_CSTPIU_EXTCTL_OUT_PORT_ADDR A:0x6020404
y.create.l HWIO_QDSS_CSTPIU_ITTRFLINACK_ADDR A:0x6020ee4
y.create.l HWIO_QDSS_CSTPIU_ITTRFLIN_ADDR A:0x6020ee8
y.create.l HWIO_QDSS_CSTPIU_ITATBDATA0_ADDR A:0x6020eec
y.create.l HWIO_QDSS_CSTPIU_ITATBCTR2_ADDR A:0x6020ef0
y.create.l HWIO_QDSS_CSTPIU_ITATBCTR1_ADDR A:0x6020ef4
y.create.l HWIO_QDSS_CSTPIU_ITATBCTR0_ADDR A:0x6020ef8
y.create.l HWIO_QDSS_CSTPIU_ITCTRL_ADDR A:0x6020f00
y.create.l HWIO_QDSS_CSTPIU_CLAIMSET_ADDR A:0x6020fa0
y.create.l HWIO_QDSS_CSTPIU_CLAIMCLR_ADDR A:0x6020fa4
y.create.l HWIO_QDSS_CSTPIU_LAR_ADDR A:0x6020fb0
y.create.l HWIO_QDSS_CSTPIU_LSR_ADDR A:0x6020fb4
y.create.l HWIO_QDSS_CSTPIU_AUTHSTATUS_ADDR A:0x6020fb8
y.create.l HWIO_QDSS_CSTPIU_DEVID_ADDR A:0x6020fc8
y.create.l HWIO_QDSS_CSTPIU_DEVTYPE_ADDR A:0x6020fcc
y.create.l HWIO_QDSS_CSTPIU_PERIPHID0_ADDR A:0x6020fe0
y.create.l HWIO_QDSS_CSTPIU_PERIPHID1_ADDR A:0x6020fe4
y.create.l HWIO_QDSS_CSTPIU_PERIPHID2_ADDR A:0x6020fe8
y.create.l HWIO_QDSS_CSTPIU_PERIPHID3_ADDR A:0x6020fec
y.create.l HWIO_QDSS_CSTPIU_PERIPHID4_ADDR A:0x6020fd0
y.create.l HWIO_QDSS_CSTPIU_PERIPHID5_ADDR A:0x6020fd4
y.create.l HWIO_QDSS_CSTPIU_PERIPHID6_ADDR A:0x6020fd8
y.create.l HWIO_QDSS_CSTPIU_PERIPHID7_ADDR A:0x6020fdc
y.create.l HWIO_QDSS_CSTPIU_COMPID0_ADDR A:0x6020ff0
y.create.l HWIO_QDSS_CSTPIU_COMPID1_ADDR A:0x6020ff4
y.create.l HWIO_QDSS_CSTPIU_COMPID2_ADDR A:0x6020ff8
y.create.l HWIO_QDSS_CSTPIU_COMPID3_ADDR A:0x6020ffc
y.create.l HWIO_QDSS_IN_FUN0_CTRL_REG_ADDR A:0x6021000
y.create.l HWIO_QDSS_IN_FUN0_PRIORITY_CTRL_REG_ADDR A:0x6021004
y.create.l HWIO_QDSS_IN_FUN0_ITATBDATA0_ADDR A:0x6021eec
y.create.l HWIO_QDSS_IN_FUN0_ITATBCTR2_ADDR A:0x6021ef0
y.create.l HWIO_QDSS_IN_FUN0_ITATBCTR1_ADDR A:0x6021ef4
y.create.l HWIO_QDSS_IN_FUN0_ITATBCTR0_ADDR A:0x6021ef8
y.create.l HWIO_QDSS_IN_FUN0_ITCTRL_ADDR A:0x6021f00
y.create.l HWIO_QDSS_IN_FUN0_CLAIMSET_ADDR A:0x6021fa0
y.create.l HWIO_QDSS_IN_FUN0_CLAIMCLR_ADDR A:0x6021fa4
y.create.l HWIO_QDSS_IN_FUN0_LOCKACCESS_ADDR A:0x6021fb0
y.create.l HWIO_QDSS_IN_FUN0_LOCKSTATUS_ADDR A:0x6021fb4
y.create.l HWIO_QDSS_IN_FUN0_AUTHSTATUS_ADDR A:0x6021fb8
y.create.l HWIO_QDSS_IN_FUN0_DEVID_ADDR A:0x6021fc8
y.create.l HWIO_QDSS_IN_FUN0_DEVTYPE_ADDR A:0x6021fcc
y.create.l HWIO_QDSS_IN_FUN0_PERIPHID0_ADDR A:0x6021fe0
y.create.l HWIO_QDSS_IN_FUN0_PERIPHID1_ADDR A:0x6021fe4
y.create.l HWIO_QDSS_IN_FUN0_PERIPHID2_ADDR A:0x6021fe8
y.create.l HWIO_QDSS_IN_FUN0_PERIPHID3_ADDR A:0x6021fec
y.create.l HWIO_QDSS_IN_FUN0_PERIPHID4_ADDR A:0x6021fd0
y.create.l HWIO_QDSS_IN_FUN0_PERIPHID5_ADDR A:0x6021fd4
y.create.l HWIO_QDSS_IN_FUN0_PERIPHID6_ADDR A:0x6021fd8
y.create.l HWIO_QDSS_IN_FUN0_PERIPHID7_ADDR A:0x6021fdc
y.create.l HWIO_QDSS_IN_FUN0_COMPID0_ADDR A:0x6021ff0
y.create.l HWIO_QDSS_IN_FUN0_COMPID1_ADDR A:0x6021ff4
y.create.l HWIO_QDSS_IN_FUN0_COMPID2_ADDR A:0x6021ff8
y.create.l HWIO_QDSS_IN_FUN0_COMPID3_ADDR A:0x6021ffc
y.create.l HWIO_QDSS_REPL64_IDFILTER0_ADDR A:0x6024000
y.create.l HWIO_QDSS_REPL64_IDFILTER1_ADDR A:0x6024004
y.create.l HWIO_QDSS_REPL64_ITATBCTR0_ADDR A:0x6024efc
y.create.l HWIO_QDSS_REPL64_ITATBCTR1_ADDR A:0x6024ef8
y.create.l HWIO_QDSS_REPL64_ITCTRL_ADDR A:0x6024f00
y.create.l HWIO_QDSS_REPL64_CLAIMSET_ADDR A:0x6024fa0
y.create.l HWIO_QDSS_REPL64_CLAIMCLR_ADDR A:0x6024fa4
y.create.l HWIO_QDSS_REPL64_LAR_ADDR A:0x6024fb0
y.create.l HWIO_QDSS_REPL64_LSR_ADDR A:0x6024fb4
y.create.l HWIO_QDSS_REPL64_AUTHSTATUS_ADDR A:0x6024fb8
y.create.l HWIO_QDSS_REPL64_DEVID_ADDR A:0x6024fc8
y.create.l HWIO_QDSS_REPL64_DEVTYPE_ADDR A:0x6024fcc
y.create.l HWIO_QDSS_REPL64_PIDR0_ADDR A:0x6024fe0
y.create.l HWIO_QDSS_REPL64_PIDR1_ADDR A:0x6024fe4
y.create.l HWIO_QDSS_REPL64_PIDR2_ADDR A:0x6024fe8
y.create.l HWIO_QDSS_REPL64_PIDR3_ADDR A:0x6024fec
y.create.l HWIO_QDSS_REPL64_PIDR4_ADDR A:0x6024fd0
y.create.l HWIO_QDSS_REPL64_PIDR5_ADDR A:0x6024fd4
y.create.l HWIO_QDSS_REPL64_PIDR6_ADDR A:0x6024fd8
y.create.l HWIO_QDSS_REPL64_PIDR7_ADDR A:0x6024fdc
y.create.l HWIO_QDSS_REPL64_CIDR0_ADDR A:0x6024ff0
y.create.l HWIO_QDSS_REPL64_CIDR1_ADDR A:0x6024ff4
y.create.l HWIO_QDSS_REPL64_CIDR2_ADDR A:0x6024ff8
y.create.l HWIO_QDSS_REPL64_CIDR3_ADDR A:0x6024ffc
y.create.l HWIO_QDSS_ETFETB_RSZ_ADDR A:0x6025004
y.create.l HWIO_QDSS_ETFETB_STS_ADDR A:0x602500c
y.create.l HWIO_QDSS_ETFETB_RRD_ADDR A:0x6025010
y.create.l HWIO_QDSS_ETFETB_RRP_ADDR A:0x6025014
y.create.l HWIO_QDSS_ETFETB_RWP_ADDR A:0x6025018
y.create.l HWIO_QDSS_ETFETB_TRG_ADDR A:0x602501c
y.create.l HWIO_QDSS_ETFETB_CTL_ADDR A:0x6025020
y.create.l HWIO_QDSS_ETFETB_RWD_ADDR A:0x6025024
y.create.l HWIO_QDSS_ETFETB_MODE_ADDR A:0x6025028
y.create.l HWIO_QDSS_ETFETB_LBUFLEVEL_ADDR A:0x602502c
y.create.l HWIO_QDSS_ETFETB_CBUFLEVEL_ADDR A:0x6025030
y.create.l HWIO_QDSS_ETFETB_BUFWM_ADDR A:0x6025034
y.create.l HWIO_QDSS_ETFETB_FFSR_ADDR A:0x6025300
y.create.l HWIO_QDSS_ETFETB_FFCR_ADDR A:0x6025304
y.create.l HWIO_QDSS_ETFETB_PSCR_ADDR A:0x6025308
y.create.l HWIO_QDSS_ETFETB_ITATBMDATA0_ADDR A:0x6025ed0
y.create.l HWIO_QDSS_ETFETB_ITATBMCTR2_ADDR A:0x6025ed4
y.create.l HWIO_QDSS_ETFETB_ITATBMCTR1_ADDR A:0x6025ed8
y.create.l HWIO_QDSS_ETFETB_ITATBMCTR0_ADDR A:0x6025edc
y.create.l HWIO_QDSS_ETFETB_ITMISCOP0_ADDR A:0x6025ee0
y.create.l HWIO_QDSS_ETFETB_ITTRFLIN_ADDR A:0x6025ee8
y.create.l HWIO_QDSS_ETFETB_ITATBDATA0_ADDR A:0x6025eec
y.create.l HWIO_QDSS_ETFETB_ITATBCTR2_ADDR A:0x6025ef0
y.create.l HWIO_QDSS_ETFETB_ITATBCTR1_ADDR A:0x6025ef4
y.create.l HWIO_QDSS_ETFETB_ITATBCTR0_ADDR A:0x6025ef8
y.create.l HWIO_QDSS_ETFETB_ITCTRL_ADDR A:0x6025f00
y.create.l HWIO_QDSS_ETFETB_CLAIMSET_ADDR A:0x6025fa0
y.create.l HWIO_QDSS_ETFETB_CLAIMCLR_ADDR A:0x6025fa4
y.create.l HWIO_QDSS_ETFETB_LAR_ADDR A:0x6025fb0
y.create.l HWIO_QDSS_ETFETB_LSR_ADDR A:0x6025fb4
y.create.l HWIO_QDSS_ETFETB_AUTHSTATUS_ADDR A:0x6025fb8
y.create.l HWIO_QDSS_ETFETB_DEVID_ADDR A:0x6025fc8
y.create.l HWIO_QDSS_ETFETB_DEVTYPE_ADDR A:0x6025fcc
y.create.l HWIO_QDSS_ETFETB_PERIPHID0_ADDR A:0x6025fe0
y.create.l HWIO_QDSS_ETFETB_PERIPHID1_ADDR A:0x6025fe4
y.create.l HWIO_QDSS_ETFETB_PERIPHID2_ADDR A:0x6025fe8
y.create.l HWIO_QDSS_ETFETB_PERIPHID3_ADDR A:0x6025fec
y.create.l HWIO_QDSS_ETFETB_PERIPHID4_ADDR A:0x6025fd0
y.create.l HWIO_QDSS_ETFETB_PERIPHID5_ADDR A:0x6025fd4
y.create.l HWIO_QDSS_ETFETB_PERIPHID6_ADDR A:0x6025fd8
y.create.l HWIO_QDSS_ETFETB_PERIPHID7_ADDR A:0x6025fdc
y.create.l HWIO_QDSS_ETFETB_COMPID0_ADDR A:0x6025ff0
y.create.l HWIO_QDSS_ETFETB_COMPID1_ADDR A:0x6025ff4
y.create.l HWIO_QDSS_ETFETB_COMPID2_ADDR A:0x6025ff8
y.create.l HWIO_QDSS_ETFETB_COMPID3_ADDR A:0x6025ffc
y.create.l HWIO_QDSS_ETR_RSZ_ADDR A:0x6026004
y.create.l HWIO_QDSS_ETR_STS_ADDR A:0x602600c
y.create.l HWIO_QDSS_ETR_RRD_ADDR A:0x6026010
y.create.l HWIO_QDSS_ETR_RRP_ADDR A:0x6026014
y.create.l HWIO_QDSS_ETR_RWP_ADDR A:0x6026018
y.create.l HWIO_QDSS_ETR_TRG_ADDR A:0x602601c
y.create.l HWIO_QDSS_ETR_CTL_ADDR A:0x6026020
y.create.l HWIO_QDSS_ETR_RWD_ADDR A:0x6026024
y.create.l HWIO_QDSS_ETR_MODE_ADDR A:0x6026028
y.create.l HWIO_QDSS_ETR_LBUFLEVEL_ADDR A:0x602602c
y.create.l HWIO_QDSS_ETR_CBUFLEVEL_ADDR A:0x6026030
y.create.l HWIO_QDSS_ETR_BUFWM_ADDR A:0x6026034
y.create.l HWIO_QDSS_ETR_RRPHI_ADDR A:0x6026038
y.create.l HWIO_QDSS_ETR_RWPHI_ADDR A:0x602603c
y.create.l HWIO_QDSS_ETR_AXICTL_ADDR A:0x6026110
y.create.l HWIO_QDSS_ETR_DBALO_ADDR A:0x6026118
y.create.l HWIO_QDSS_ETR_DBAHI_ADDR A:0x602611c
y.create.l HWIO_QDSS_ETR_FFSR_ADDR A:0x6026300
y.create.l HWIO_QDSS_ETR_FFCR_ADDR A:0x6026304
y.create.l HWIO_QDSS_ETR_PSCR_ADDR A:0x6026308
y.create.l HWIO_QDSS_ETR_ITMISCOP0_ADDR A:0x6026ee0
y.create.l HWIO_QDSS_ETR_ITTRFLIN_ADDR A:0x6026ee8
y.create.l HWIO_QDSS_ETR_ITATBDATA0_ADDR A:0x6026eec
y.create.l HWIO_QDSS_ETR_ITATBCTR2_ADDR A:0x6026ef0
y.create.l HWIO_QDSS_ETR_ITATBCTR1_ADDR A:0x6026ef4
y.create.l HWIO_QDSS_ETR_ITATBCTR0_ADDR A:0x6026ef8
y.create.l HWIO_QDSS_ETR_ITCTRL_ADDR A:0x6026f00
y.create.l HWIO_QDSS_ETR_CLAIMSET_ADDR A:0x6026fa0
y.create.l HWIO_QDSS_ETR_CLAIMCLR_ADDR A:0x6026fa4
y.create.l HWIO_QDSS_ETR_LAR_ADDR A:0x6026fb0
y.create.l HWIO_QDSS_ETR_LSR_ADDR A:0x6026fb4
y.create.l HWIO_QDSS_ETR_AUTHSTATUS_ADDR A:0x6026fb8
y.create.l HWIO_QDSS_ETR_DEVID_ADDR A:0x6026fc8
y.create.l HWIO_QDSS_ETR_DEVTYPE_ADDR A:0x6026fcc
y.create.l HWIO_QDSS_ETR_PERIPHID0_ADDR A:0x6026fe0
y.create.l HWIO_QDSS_ETR_PERIPHID1_ADDR A:0x6026fe4
y.create.l HWIO_QDSS_ETR_PERIPHID2_ADDR A:0x6026fe8
y.create.l HWIO_QDSS_ETR_PERIPHID3_ADDR A:0x6026fec
y.create.l HWIO_QDSS_ETR_PERIPHID4_ADDR A:0x6026fd0
y.create.l HWIO_QDSS_ETR_PERIPHID5_ADDR A:0x6026fd4
y.create.l HWIO_QDSS_ETR_PERIPHID6_ADDR A:0x6026fd8
y.create.l HWIO_QDSS_ETR_PERIPHID7_ADDR A:0x6026fdc
y.create.l HWIO_QDSS_ETR_COMPID0_ADDR A:0x6026ff0
y.create.l HWIO_QDSS_ETR_COMPID1_ADDR A:0x6026ff4
y.create.l HWIO_QDSS_ETR_COMPID2_ADDR A:0x6026ff8
y.create.l HWIO_QDSS_ETR_COMPID3_ADDR A:0x6026ffc
y.create.l HWIO_QDSS_WRAPPER_ATB_FUN2X1_CTRL_REG_ADDR A:0x6068000
y.create.l HWIO_QDSS_WRAPPER_ATB_FUN2X1_PRIORITY_CTRL_REG_ADDR A:0x6068004
y.create.l HWIO_QDSS_WRAPPER_ATB_FUN2X1_ITATBDATA0_ADDR A:0x6068eec
y.create.l HWIO_QDSS_WRAPPER_ATB_FUN2X1_ITATBCTR2_ADDR A:0x6068ef0
y.create.l HWIO_QDSS_WRAPPER_ATB_FUN2X1_ITATBCTR1_ADDR A:0x6068ef4
y.create.l HWIO_QDSS_WRAPPER_ATB_FUN2X1_ITATBCTR0_ADDR A:0x6068ef8
y.create.l HWIO_QDSS_WRAPPER_ATB_FUN2X1_ITCTRL_ADDR A:0x6068f00
y.create.l HWIO_QDSS_WRAPPER_ATB_FUN2X1_CLAIMSET_ADDR A:0x6068fa0
y.create.l HWIO_QDSS_WRAPPER_ATB_FUN2X1_CLAIMCLR_ADDR A:0x6068fa4
y.create.l HWIO_QDSS_WRAPPER_ATB_FUN2X1_LOCKACCESS_ADDR A:0x6068fb0
y.create.l HWIO_QDSS_WRAPPER_ATB_FUN2X1_LOCKSTATUS_ADDR A:0x6068fb4
y.create.l HWIO_QDSS_WRAPPER_ATB_FUN2X1_AUTHSTATUS_ADDR A:0x6068fb8
y.create.l HWIO_QDSS_WRAPPER_ATB_FUN2X1_DEVID_ADDR A:0x6068fc8
y.create.l HWIO_QDSS_WRAPPER_ATB_FUN2X1_DEVTYPE_ADDR A:0x6068fcc
y.create.l HWIO_QDSS_WRAPPER_ATB_FUN2X1_PERIPHID0_ADDR A:0x6068fe0
y.create.l HWIO_QDSS_WRAPPER_ATB_FUN2X1_PERIPHID1_ADDR A:0x6068fe4
y.create.l HWIO_QDSS_WRAPPER_ATB_FUN2X1_PERIPHID2_ADDR A:0x6068fe8
y.create.l HWIO_QDSS_WRAPPER_ATB_FUN2X1_PERIPHID3_ADDR A:0x6068fec
y.create.l HWIO_QDSS_WRAPPER_ATB_FUN2X1_PERIPHID4_ADDR A:0x6068fd0
y.create.l HWIO_QDSS_WRAPPER_ATB_FUN2X1_PERIPHID5_ADDR A:0x6068fd4
y.create.l HWIO_QDSS_WRAPPER_ATB_FUN2X1_PERIPHID6_ADDR A:0x6068fd8
y.create.l HWIO_QDSS_WRAPPER_ATB_FUN2X1_PERIPHID7_ADDR A:0x6068fdc
y.create.l HWIO_QDSS_WRAPPER_ATB_FUN2X1_COMPID0_ADDR A:0x6068ff0
y.create.l HWIO_QDSS_WRAPPER_ATB_FUN2X1_COMPID1_ADDR A:0x6068ff4
y.create.l HWIO_QDSS_WRAPPER_ATB_FUN2X1_COMPID2_ADDR A:0x6068ff8
y.create.l HWIO_QDSS_WRAPPER_ATB_FUN2X1_COMPID3_ADDR A:0x6068ffc
y.create.l HWIO_QDSS_WRAPPER_HWEVENT_EXPD_COL0_OEN_REG_ADDR A:0x606c000
y.create.l HWIO_QDSS_WRAPPER_HWEVENT_EXPD_COL1_OEN_REG_ADDR A:0x606c004
y.create.l HWIO_QDSS_WRAPPER_HWEVENT_EXPD_COL2_OEN_REG_ADDR A:0x606c008
y.create.l HWIO_QDSS_WRAPPER_HWEVENT_EXPD_COL3_OEN_REG_ADDR A:0x606c00c
y.create.l HWIO_QDSS_WRAPPER_HWEVENT_EXPD_COL4_OEN_REG_ADDR A:0x606c010
y.create.l HWIO_QDSS_WRAPPER_HWEVENT_EXPD_COL5_OEN_REG_ADDR A:0x606c014
y.create.l HWIO_QDSS_WRAPPER_HWEVENT_EXPD_COL6_OEN_REG_ADDR A:0x606c018
y.create.l HWIO_QDSS_WRAPPER_HWEVENT_EXPD_COL7_OEN_REG_ADDR A:0x606c01c
y.create.l HWIO_QDSS_WRAPPER_HWEVENT_EXPD_COL8_OEN_REG_ADDR A:0x606c020
y.create.l HWIO_QDSS_WRAPPER_HWEVENT_EXPD_COL9_OEN_REG_ADDR A:0x606c024
y.create.l HWIO_QDSS_WRAPPER_HWEVENT_EXPD_COL0_MUX_SEL0_REG_ADDR A:0x606c040
y.create.l HWIO_QDSS_WRAPPER_HWEVENT_EXPD_COL1_MUX_SEL0_REG_ADDR A:0x606c050
y.create.l HWIO_QDSS_WRAPPER_HWEVENT_EXPD_COL2_MUX_SEL0_REG_ADDR A:0x606c060
y.create.l HWIO_QDSS_WRAPPER_HWEVENT_EXPD_COL3_MUX_SEL0_REG_ADDR A:0x606c070
y.create.l HWIO_QDSS_WRAPPER_HWEVENT_EXPD_COL4_MUX_SEL0_REG_ADDR A:0x606c080
y.create.l HWIO_QDSS_WRAPPER_HWEVENT_EXPD_COL5_MUX_SEL0_REG_ADDR A:0x606c090
y.create.l HWIO_QDSS_WRAPPER_HWEVENT_EXPD_COL6_MUX_SEL0_REG_ADDR A:0x606c0a0
y.create.l HWIO_QDSS_WRAPPER_HWEVENT_EXPD_COL7_MUX_SEL0_REG_ADDR A:0x606c0b0
y.create.l HWIO_QDSS_WRAPPER_HWEVENT_EXPD_COL8_MUX_SEL0_REG_ADDR A:0x606c0c0
y.create.l HWIO_QDSS_WRAPPER_HWEVENT_EXPD_COL9_MUX_SEL0_REG_ADDR A:0x606c0d0
y.create.l HWIO_QDSS_WRAPPER_HWEVENT_EXPD_COL0_MUX_SEL1_REG_ADDR A:0x606c044
y.create.l HWIO_QDSS_WRAPPER_HWEVENT_EXPD_COL1_MUX_SEL1_REG_ADDR A:0x606c054
y.create.l HWIO_QDSS_WRAPPER_HWEVENT_EXPD_COL2_MUX_SEL1_REG_ADDR A:0x606c064
y.create.l HWIO_QDSS_WRAPPER_HWEVENT_EXPD_COL3_MUX_SEL1_REG_ADDR A:0x606c074
y.create.l HWIO_QDSS_WRAPPER_HWEVENT_EXPD_COL4_MUX_SEL1_REG_ADDR A:0x606c084
y.create.l HWIO_QDSS_WRAPPER_HWEVENT_EXPD_COL5_MUX_SEL1_REG_ADDR A:0x606c094
y.create.l HWIO_QDSS_WRAPPER_HWEVENT_EXPD_COL6_MUX_SEL1_REG_ADDR A:0x606c0a4
y.create.l HWIO_QDSS_WRAPPER_HWEVENT_EXPD_COL7_MUX_SEL1_REG_ADDR A:0x606c0b4
y.create.l HWIO_QDSS_WRAPPER_HWEVENT_EXPD_COL8_MUX_SEL1_REG_ADDR A:0x606c0c4
y.create.l HWIO_QDSS_WRAPPER_HWEVENT_EXPD_COL9_MUX_SEL1_REG_ADDR A:0x606c0d4
y.create.l HWIO_QDSS_WRAPPER_HWEVENT_EXPD_COL0_MUX_SEL2_REG_ADDR A:0x606c048
y.create.l HWIO_QDSS_WRAPPER_HWEVENT_EXPD_COL1_MUX_SEL2_REG_ADDR A:0x606c058
y.create.l HWIO_QDSS_WRAPPER_HWEVENT_EXPD_COL2_MUX_SEL2_REG_ADDR A:0x606c068
y.create.l HWIO_QDSS_WRAPPER_HWEVENT_EXPD_COL3_MUX_SEL2_REG_ADDR A:0x606c078
y.create.l HWIO_QDSS_WRAPPER_HWEVENT_EXPD_COL4_MUX_SEL2_REG_ADDR A:0x606c088
y.create.l HWIO_QDSS_WRAPPER_HWEVENT_EXPD_COL5_MUX_SEL2_REG_ADDR A:0x606c098
y.create.l HWIO_QDSS_WRAPPER_HWEVENT_EXPD_COL6_MUX_SEL2_REG_ADDR A:0x606c0a8
y.create.l HWIO_QDSS_WRAPPER_HWEVENT_EXPD_COL7_MUX_SEL2_REG_ADDR A:0x606c0b8
y.create.l HWIO_QDSS_WRAPPER_HWEVENT_EXPD_COL8_MUX_SEL2_REG_ADDR A:0x606c0c8
y.create.l HWIO_QDSS_WRAPPER_HWEVENT_EXPD_COL9_MUX_SEL2_REG_ADDR A:0x606c0d8
y.create.l HWIO_QDSS_WRAPPER_HWEVENT_EXPD_COL0_MUX_SEL3_REG_ADDR A:0x606c04c
y.create.l HWIO_QDSS_WRAPPER_HWEVENT_EXPD_COL1_MUX_SEL3_REG_ADDR A:0x606c05c
y.create.l HWIO_QDSS_WRAPPER_HWEVENT_EXPD_COL2_MUX_SEL3_REG_ADDR A:0x606c06c
y.create.l HWIO_QDSS_WRAPPER_HWEVENT_EXPD_COL3_MUX_SEL3_REG_ADDR A:0x606c07c
y.create.l HWIO_QDSS_WRAPPER_HWEVENT_EXPD_COL4_MUX_SEL3_REG_ADDR A:0x606c08c
y.create.l HWIO_QDSS_WRAPPER_HWEVENT_EXPD_COL5_MUX_SEL3_REG_ADDR A:0x606c09c
y.create.l HWIO_QDSS_WRAPPER_HWEVENT_EXPD_COL6_MUX_SEL3_REG_ADDR A:0x606c0ac
y.create.l HWIO_QDSS_WRAPPER_HWEVENT_EXPD_COL7_MUX_SEL3_REG_ADDR A:0x606c0bc
y.create.l HWIO_QDSS_WRAPPER_HWEVENT_EXPD_COL8_MUX_SEL3_REG_ADDR A:0x606c0cc
y.create.l HWIO_QDSS_WRAPPER_HWEVENT_EXPD_COL9_MUX_SEL3_REG_ADDR A:0x606c0dc
y.create.l HWIO_QDSS_WRAPPER_IRQ_MUX_REG_ADDR A:0x606c140
y.create.l HWIO_QDSS_WRAPPER_HWE_SPDM_MUX_REG_ADDR A:0x606c144
y.create.l HWIO_QDSS_WRAPPER_CS_HWE_EXPD_ITCTL_ADDR A:0x606cf00
y.create.l HWIO_QDSS_WRAPPER_CS_HWE_EXPD_CLAIMSET_ADDR A:0x606cfa0
y.create.l HWIO_QDSS_WRAPPER_CS_HWE_EXPD_CLAIMCLR_ADDR A:0x606cfa4
y.create.l HWIO_QDSS_WRAPPER_CS_HWE_EXPD_LOCKACCESS_ADDR A:0x606cfb0
y.create.l HWIO_QDSS_WRAPPER_CS_HWE_EXPD_LOCKSTATUS_ADDR A:0x606cfb4
y.create.l HWIO_QDSS_WRAPPER_CS_HWE_EXPD_AUTHSTATUS_ADDR A:0x606cfb8
y.create.l HWIO_QDSS_WRAPPER_CS_HWE_EXPD_DEVICEID_ADDR A:0x606cfc8
y.create.l HWIO_QDSS_WRAPPER_CS_HWE_EXPD_DEVICETYPE_ADDR A:0x606cfcc
y.create.l HWIO_QDSS_WRAPPER_CS_HWE_EXPD_PERIPHID4_ADDR A:0x606cfd0
y.create.l HWIO_QDSS_WRAPPER_CS_HWE_EXPD_PERIPHID5_ADDR A:0x606cfd4
y.create.l HWIO_QDSS_WRAPPER_CS_HWE_EXPD_PERIPHID6_ADDR A:0x606cfd8
y.create.l HWIO_QDSS_WRAPPER_CS_HWE_EXPD_PERIPHID7_ADDR A:0x606cfdc
y.create.l HWIO_QDSS_WRAPPER_CS_HWE_EXPD_PERIPHID0_ADDR A:0x606cfe0
y.create.l HWIO_QDSS_WRAPPER_CS_HWE_EXPD_PERIPHID1_ADDR A:0x606cfe4
y.create.l HWIO_QDSS_WRAPPER_CS_HWE_EXPD_PERIPHID2_ADDR A:0x606cfe8
y.create.l HWIO_QDSS_WRAPPER_CS_HWE_EXPD_PERIPHID3_ADDR A:0x606cfec
y.create.l HWIO_QDSS_WRAPPER_CS_HWE_EXPD_COMPID0_ADDR A:0x606cff0
y.create.l HWIO_QDSS_WRAPPER_CS_HWE_EXPD_COMPID1_ADDR A:0x606cff4
y.create.l HWIO_QDSS_WRAPPER_CS_HWE_EXPD_COMPID2_ADDR A:0x606cff8
y.create.l HWIO_QDSS_WRAPPER_CS_HWE_EXPD_COMPID3_ADDR A:0x606cffc
y.create.l HWIO_QDSS_WRAPPER_DEBUG_UI_SECURE_ADDR A:0x606d000
y.create.l HWIO_QDSS_WRAPPER_DEBUG_UI_CTL_ADDR A:0x606d004
y.create.l HWIO_QDSS_WRAPPER_DEBUG_UI_CTL_MASK_ADDR A:0x606d008
y.create.l HWIO_QDSS_WRAPPER_DEBUG_UI_SWTRIG_ADDR A:0x606d00c
y.create.l HWIO_QDSS_WRAPPER_DEBUG_UI_STATUS_ADDR A:0x606d010
y.create.l HWIO_QDSS_WRAPPER_DEBUG_UI_HWE_MASK_ADDR A:0x606d014
y.create.l HWIO_QDSS_WRAPPER_DEBUG_UI_CTR_VAL_ADDR A:0x606d018
y.create.l HWIO_QDSS_WRAPPER_DEBUG_UI_CTR_EN_ADDR A:0x606d01c
y.create.l HWIO_QDSS_WRAPPER_DEBUG_UI_NUM_REGS_RD_ADDR A:0x606d020
y.create.l HWIO_QDSS_WRAPPER_DEBUG_UI_ATB_REG_ADDR A:0x606d024
y.create.l HWIO_QDSS_WRAPPER_DEBUG_UI_NUM_ADDR_REG_ADDR A:0x606d028
y.create.l HWIO_QDSS_WRAPPER_DEBUG_UI_ADDR_0_ADDR A:0x606d030
y.create.l HWIO_QDSS_WRAPPER_DEBUG_UI_ADDR_1_ADDR A:0x606d034
y.create.l HWIO_QDSS_WRAPPER_DEBUG_UI_ADDR_2_ADDR A:0x606d038
y.create.l HWIO_QDSS_WRAPPER_DEBUG_UI_ADDR_3_ADDR A:0x606d03c
y.create.l HWIO_QDSS_WRAPPER_DEBUG_UI_ADDR_4_ADDR A:0x606d040
y.create.l HWIO_QDSS_WRAPPER_DEBUG_UI_ADDR_5_ADDR A:0x606d044
y.create.l HWIO_QDSS_WRAPPER_DEBUG_UI_ADDR_6_ADDR A:0x606d048
y.create.l HWIO_QDSS_WRAPPER_DEBUG_UI_ADDR_7_ADDR A:0x606d04c
y.create.l HWIO_QDSS_WRAPPER_DEBUG_UI_ADDR_8_ADDR A:0x606d050
y.create.l HWIO_QDSS_WRAPPER_DEBUG_UI_ADDR_9_ADDR A:0x606d054
y.create.l HWIO_QDSS_WRAPPER_DEBUG_UI_ADDR_10_ADDR A:0x606d058
y.create.l HWIO_QDSS_WRAPPER_DEBUG_UI_ADDR_11_ADDR A:0x606d05c
y.create.l HWIO_QDSS_WRAPPER_DEBUG_UI_ADDR_12_ADDR A:0x606d060
y.create.l HWIO_QDSS_WRAPPER_DEBUG_UI_DATA_0_ADDR A:0x606d0b0
y.create.l HWIO_QDSS_WRAPPER_DEBUG_UI_DATA_1_ADDR A:0x606d0b4
y.create.l HWIO_QDSS_WRAPPER_DEBUG_UI_DATA_2_ADDR A:0x606d0b8
y.create.l HWIO_QDSS_WRAPPER_DEBUG_UI_DATA_3_ADDR A:0x606d0bc
y.create.l HWIO_QDSS_WRAPPER_DEBUG_UI_DATA_4_ADDR A:0x606d0c0
y.create.l HWIO_QDSS_WRAPPER_DEBUG_UI_DATA_5_ADDR A:0x606d0c4
y.create.l HWIO_QDSS_WRAPPER_DEBUG_UI_DATA_6_ADDR A:0x606d0c8
y.create.l HWIO_QDSS_WRAPPER_DEBUG_UI_DATA_7_ADDR A:0x606d0cc
y.create.l HWIO_QDSS_WRAPPER_DEBUG_UI_DATA_8_ADDR A:0x606d0d0
y.create.l HWIO_QDSS_WRAPPER_DEBUG_UI_DATA_9_ADDR A:0x606d0d4
y.create.l HWIO_QDSS_WRAPPER_CS_DEBUG_UI_ITCTL_ADDR A:0x606df00
y.create.l HWIO_QDSS_WRAPPER_CS_DEBUG_UI_CLAIMSET_ADDR A:0x606dfa0
y.create.l HWIO_QDSS_WRAPPER_CS_DEBUG_UI_CLAIMCLR_ADDR A:0x606dfa4
y.create.l HWIO_QDSS_WRAPPER_CS_DEBUG_UI_LOCKACCESS_ADDR A:0x606dfb0
y.create.l HWIO_QDSS_WRAPPER_CS_DEBUG_UI_LOCKSTATUS_ADDR A:0x606dfb4
y.create.l HWIO_QDSS_WRAPPER_CS_DEBUG_UI_AUTHSTATUS_ADDR A:0x606dfb8
y.create.l HWIO_QDSS_WRAPPER_CS_DEBUG_UI_DEVICEID_ADDR A:0x606dfc8
y.create.l HWIO_QDSS_WRAPPER_CS_DEBUG_UI_DEVICETYPE_ADDR A:0x606dfcc
y.create.l HWIO_QDSS_WRAPPER_CS_DEBUG_UI_PERIPHID4_ADDR A:0x606dfd0
y.create.l HWIO_QDSS_WRAPPER_CS_DEBUG_UI_PERIPHID5_ADDR A:0x606dfd4
y.create.l HWIO_QDSS_WRAPPER_CS_DEBUG_UI_PERIPHID6_ADDR A:0x606dfd8
y.create.l HWIO_QDSS_WRAPPER_CS_DEBUG_UI_PERIPHID7_ADDR A:0x606dfdc
y.create.l HWIO_QDSS_WRAPPER_CS_DEBUG_UI_PERIPHID0_ADDR A:0x606dfe0
y.create.l HWIO_QDSS_WRAPPER_CS_DEBUG_UI_PERIPHID1_ADDR A:0x606dfe4
y.create.l HWIO_QDSS_WRAPPER_CS_DEBUG_UI_PERIPHID2_ADDR A:0x606dfe8
y.create.l HWIO_QDSS_WRAPPER_CS_DEBUG_UI_PERIPHID3_ADDR A:0x606dfec
y.create.l HWIO_QDSS_WRAPPER_CS_DEBUG_UI_COMPID0_ADDR A:0x606dff0
y.create.l HWIO_QDSS_WRAPPER_CS_DEBUG_UI_COMPID1_ADDR A:0x606dff4
y.create.l HWIO_QDSS_WRAPPER_CS_DEBUG_UI_COMPID2_ADDR A:0x606dff8
y.create.l HWIO_QDSS_WRAPPER_CS_DEBUG_UI_COMPID3_ADDR A:0x606dffc
y.create.l HWIO_QPIC_QPIC_BAM_CTRL_ADDR A:0x7984000
y.create.l HWIO_QPIC_QPIC_BAM_TIMER_ADDR A:0x7984040
y.create.l HWIO_QPIC_QPIC_BAM_TIMER_CTRL_ADDR A:0x7984044
y.create.l HWIO_QPIC_QPIC_BAM_DESC_CNT_TRSHLD_ADDR A:0x7984008
y.create.l HWIO_QPIC_QPIC_BAM_IRQ_STTS_ADDR A:0x7984014
y.create.l HWIO_QPIC_QPIC_BAM_IRQ_CLR_ADDR A:0x7984018
y.create.l HWIO_QPIC_QPIC_BAM_IRQ_EN_ADDR A:0x798401c
y.create.l HWIO_QPIC_QPIC_BAM_CNFG_BITS_ADDR A:0x798407c
y.create.l HWIO_QPIC_QPIC_BAM_REVISION_ADDR A:0x7985000
y.create.l HWIO_QPIC_QPIC_BAM_SW_VERSION_ADDR A:0x7985004
y.create.l HWIO_QPIC_QPIC_BAM_NUM_PIPES_ADDR A:0x7985008
y.create.l HWIO_QPIC_QPIC_BAM_TEST_BUS_SEL_ADDR A:0x7985010
y.create.l HWIO_QPIC_QPIC_BAM_TEST_BUS_REG_ADDR A:0x7985014
y.create.l HWIO_QPIC_QPIC_BAM_AHB_MASTER_ERR_CTRLS_ADDR A:0x7985024
y.create.l HWIO_QPIC_QPIC_BAM_AHB_MASTER_ERR_ADDR_ADDR A:0x7985028
y.create.l HWIO_QPIC_QPIC_BAM_AHB_MASTER_ERR_DATA_ADDR A:0x798502c
y.create.l HWIO_QPIC_QPIC_BAM_AHB_MASTER_ERR_ADDR_LSB_ADDR A:0x7985100
y.create.l HWIO_QPIC_QPIC_BAM_AHB_MASTER_ERR_ADDR_MSB_ADDR A:0x7985104
y.create.l HWIO_QPIC_QPIC_BAM_TRUST_REG_ADDR A:0x7986000
y.create.l HWIO_QPIC_QPIC_BAM_P_TRUST_REG0_ADDR A:0x7986020
y.create.l HWIO_QPIC_QPIC_BAM_P_TRUST_REG1_ADDR A:0x7986024
y.create.l HWIO_QPIC_QPIC_BAM_P_TRUST_REG2_ADDR A:0x7986028
y.create.l HWIO_QPIC_QPIC_BAM_P_TRUST_REG3_ADDR A:0x798602c
y.create.l HWIO_QPIC_QPIC_BAM_P_TRUST_REG4_ADDR A:0x7986030
y.create.l HWIO_QPIC_QPIC_BAM_P_TRUST_REG5_ADDR A:0x7986034
y.create.l HWIO_QPIC_QPIC_BAM_P_TRUST_REG6_ADDR A:0x7986038
y.create.l HWIO_QPIC_QPIC_BAM_IRQ_SRCS_EE0_ADDR A:0x7987000
y.create.l HWIO_QPIC_QPIC_BAM_IRQ_SRCS_EE1_ADDR A:0x7988000
y.create.l HWIO_QPIC_QPIC_BAM_IRQ_SRCS_EE2_ADDR A:0x7989000
y.create.l HWIO_QPIC_QPIC_BAM_IRQ_SRCS_EE3_ADDR A:0x798a000
y.create.l HWIO_QPIC_QPIC_BAM_IRQ_SRCS_EE4_ADDR A:0x798b000
y.create.l HWIO_QPIC_QPIC_BAM_IRQ_SRCS_EE5_ADDR A:0x798c000
y.create.l HWIO_QPIC_QPIC_BAM_IRQ_SRCS_EE6_ADDR A:0x798d000
y.create.l HWIO_QPIC_QPIC_BAM_IRQ_SRCS_EE7_ADDR A:0x798e000
y.create.l HWIO_QPIC_QPIC_BAM_IRQ_SRCS_MSK_EE0_ADDR A:0x7987004
y.create.l HWIO_QPIC_QPIC_BAM_IRQ_SRCS_MSK_EE1_ADDR A:0x7988004
y.create.l HWIO_QPIC_QPIC_BAM_IRQ_SRCS_MSK_EE2_ADDR A:0x7989004
y.create.l HWIO_QPIC_QPIC_BAM_IRQ_SRCS_MSK_EE3_ADDR A:0x798a004
y.create.l HWIO_QPIC_QPIC_BAM_IRQ_SRCS_MSK_EE4_ADDR A:0x798b004
y.create.l HWIO_QPIC_QPIC_BAM_IRQ_SRCS_MSK_EE5_ADDR A:0x798c004
y.create.l HWIO_QPIC_QPIC_BAM_IRQ_SRCS_MSK_EE6_ADDR A:0x798d004
y.create.l HWIO_QPIC_QPIC_BAM_IRQ_SRCS_MSK_EE7_ADDR A:0x798e004
y.create.l HWIO_QPIC_QPIC_BAM_IRQ_SRCS_UNMASKED_EE0_ADDR A:0x7987008
y.create.l HWIO_QPIC_QPIC_BAM_IRQ_SRCS_UNMASKED_EE1_ADDR A:0x7988008
y.create.l HWIO_QPIC_QPIC_BAM_IRQ_SRCS_UNMASKED_EE2_ADDR A:0x7989008
y.create.l HWIO_QPIC_QPIC_BAM_IRQ_SRCS_UNMASKED_EE3_ADDR A:0x798a008
y.create.l HWIO_QPIC_QPIC_BAM_IRQ_SRCS_UNMASKED_EE4_ADDR A:0x798b008
y.create.l HWIO_QPIC_QPIC_BAM_IRQ_SRCS_UNMASKED_EE5_ADDR A:0x798c008
y.create.l HWIO_QPIC_QPIC_BAM_IRQ_SRCS_UNMASKED_EE6_ADDR A:0x798d008
y.create.l HWIO_QPIC_QPIC_BAM_IRQ_SRCS_UNMASKED_EE7_ADDR A:0x798e008
y.create.l HWIO_QPIC_QPIC_BAM_PIPE_ATTR_EE0_ADDR A:0x798700c
y.create.l HWIO_QPIC_QPIC_BAM_PIPE_ATTR_EE1_ADDR A:0x798800c
y.create.l HWIO_QPIC_QPIC_BAM_PIPE_ATTR_EE2_ADDR A:0x798900c
y.create.l HWIO_QPIC_QPIC_BAM_PIPE_ATTR_EE3_ADDR A:0x798a00c
y.create.l HWIO_QPIC_QPIC_BAM_PIPE_ATTR_EE4_ADDR A:0x798b00c
y.create.l HWIO_QPIC_QPIC_BAM_PIPE_ATTR_EE5_ADDR A:0x798c00c
y.create.l HWIO_QPIC_QPIC_BAM_PIPE_ATTR_EE6_ADDR A:0x798d00c
y.create.l HWIO_QPIC_QPIC_BAM_PIPE_ATTR_EE7_ADDR A:0x798e00c
y.create.l HWIO_QPIC_QPIC_BAM_IRQ_SRCS_ADDR A:0x7987010
y.create.l HWIO_QPIC_QPIC_BAM_IRQ_SRCS_MSK_ADDR A:0x7987014
y.create.l HWIO_QPIC_QPIC_BAM_IRQ_SRCS_UNMASKED_ADDR A:0x7987018
y.create.l HWIO_QPIC_QPIC_BAM_P_CTRL0_ADDR A:0x7997000
y.create.l HWIO_QPIC_QPIC_BAM_P_CTRL1_ADDR A:0x7998000
y.create.l HWIO_QPIC_QPIC_BAM_P_CTRL2_ADDR A:0x7999000
y.create.l HWIO_QPIC_QPIC_BAM_P_CTRL3_ADDR A:0x799a000
y.create.l HWIO_QPIC_QPIC_BAM_P_CTRL4_ADDR A:0x799b000
y.create.l HWIO_QPIC_QPIC_BAM_P_CTRL5_ADDR A:0x799c000
y.create.l HWIO_QPIC_QPIC_BAM_P_CTRL6_ADDR A:0x799d000
y.create.l HWIO_QPIC_QPIC_BAM_P_RST0_ADDR A:0x7997004
y.create.l HWIO_QPIC_QPIC_BAM_P_RST1_ADDR A:0x7998004
y.create.l HWIO_QPIC_QPIC_BAM_P_RST2_ADDR A:0x7999004
y.create.l HWIO_QPIC_QPIC_BAM_P_RST3_ADDR A:0x799a004
y.create.l HWIO_QPIC_QPIC_BAM_P_RST4_ADDR A:0x799b004
y.create.l HWIO_QPIC_QPIC_BAM_P_RST5_ADDR A:0x799c004
y.create.l HWIO_QPIC_QPIC_BAM_P_RST6_ADDR A:0x799d004
y.create.l HWIO_QPIC_QPIC_BAM_P_HALT0_ADDR A:0x7997008
y.create.l HWIO_QPIC_QPIC_BAM_P_HALT1_ADDR A:0x7998008
y.create.l HWIO_QPIC_QPIC_BAM_P_HALT2_ADDR A:0x7999008
y.create.l HWIO_QPIC_QPIC_BAM_P_HALT3_ADDR A:0x799a008
y.create.l HWIO_QPIC_QPIC_BAM_P_HALT4_ADDR A:0x799b008
y.create.l HWIO_QPIC_QPIC_BAM_P_HALT5_ADDR A:0x799c008
y.create.l HWIO_QPIC_QPIC_BAM_P_HALT6_ADDR A:0x799d008
y.create.l HWIO_QPIC_QPIC_BAM_P_IRQ_STTS0_ADDR A:0x7997010
y.create.l HWIO_QPIC_QPIC_BAM_P_IRQ_STTS1_ADDR A:0x7998010
y.create.l HWIO_QPIC_QPIC_BAM_P_IRQ_STTS2_ADDR A:0x7999010
y.create.l HWIO_QPIC_QPIC_BAM_P_IRQ_STTS3_ADDR A:0x799a010
y.create.l HWIO_QPIC_QPIC_BAM_P_IRQ_STTS4_ADDR A:0x799b010
y.create.l HWIO_QPIC_QPIC_BAM_P_IRQ_STTS5_ADDR A:0x799c010
y.create.l HWIO_QPIC_QPIC_BAM_P_IRQ_STTS6_ADDR A:0x799d010
y.create.l HWIO_QPIC_QPIC_BAM_P_IRQ_CLR0_ADDR A:0x7997014
y.create.l HWIO_QPIC_QPIC_BAM_P_IRQ_CLR1_ADDR A:0x7998014
y.create.l HWIO_QPIC_QPIC_BAM_P_IRQ_CLR2_ADDR A:0x7999014
y.create.l HWIO_QPIC_QPIC_BAM_P_IRQ_CLR3_ADDR A:0x799a014
y.create.l HWIO_QPIC_QPIC_BAM_P_IRQ_CLR4_ADDR A:0x799b014
y.create.l HWIO_QPIC_QPIC_BAM_P_IRQ_CLR5_ADDR A:0x799c014
y.create.l HWIO_QPIC_QPIC_BAM_P_IRQ_CLR6_ADDR A:0x799d014
y.create.l HWIO_QPIC_QPIC_BAM_P_IRQ_EN0_ADDR A:0x7997018
y.create.l HWIO_QPIC_QPIC_BAM_P_IRQ_EN1_ADDR A:0x7998018
y.create.l HWIO_QPIC_QPIC_BAM_P_IRQ_EN2_ADDR A:0x7999018
y.create.l HWIO_QPIC_QPIC_BAM_P_IRQ_EN3_ADDR A:0x799a018
y.create.l HWIO_QPIC_QPIC_BAM_P_IRQ_EN4_ADDR A:0x799b018
y.create.l HWIO_QPIC_QPIC_BAM_P_IRQ_EN5_ADDR A:0x799c018
y.create.l HWIO_QPIC_QPIC_BAM_P_IRQ_EN6_ADDR A:0x799d018
y.create.l HWIO_QPIC_QPIC_BAM_P_TIMER0_ADDR A:0x799701c
y.create.l HWIO_QPIC_QPIC_BAM_P_TIMER1_ADDR A:0x799801c
y.create.l HWIO_QPIC_QPIC_BAM_P_TIMER2_ADDR A:0x799901c
y.create.l HWIO_QPIC_QPIC_BAM_P_TIMER3_ADDR A:0x799a01c
y.create.l HWIO_QPIC_QPIC_BAM_P_TIMER4_ADDR A:0x799b01c
y.create.l HWIO_QPIC_QPIC_BAM_P_TIMER5_ADDR A:0x799c01c
y.create.l HWIO_QPIC_QPIC_BAM_P_TIMER6_ADDR A:0x799d01c
y.create.l HWIO_QPIC_QPIC_BAM_P_TIMER_CTRL0_ADDR A:0x7997020
y.create.l HWIO_QPIC_QPIC_BAM_P_TIMER_CTRL1_ADDR A:0x7998020
y.create.l HWIO_QPIC_QPIC_BAM_P_TIMER_CTRL2_ADDR A:0x7999020
y.create.l HWIO_QPIC_QPIC_BAM_P_TIMER_CTRL3_ADDR A:0x799a020
y.create.l HWIO_QPIC_QPIC_BAM_P_TIMER_CTRL4_ADDR A:0x799b020
y.create.l HWIO_QPIC_QPIC_BAM_P_TIMER_CTRL5_ADDR A:0x799c020
y.create.l HWIO_QPIC_QPIC_BAM_P_TIMER_CTRL6_ADDR A:0x799d020
y.create.l HWIO_QPIC_QPIC_BAM_P_PRDCR_SDBND0_ADDR A:0x7997024
y.create.l HWIO_QPIC_QPIC_BAM_P_PRDCR_SDBND1_ADDR A:0x7998024
y.create.l HWIO_QPIC_QPIC_BAM_P_PRDCR_SDBND2_ADDR A:0x7999024
y.create.l HWIO_QPIC_QPIC_BAM_P_PRDCR_SDBND3_ADDR A:0x799a024
y.create.l HWIO_QPIC_QPIC_BAM_P_PRDCR_SDBND4_ADDR A:0x799b024
y.create.l HWIO_QPIC_QPIC_BAM_P_PRDCR_SDBND5_ADDR A:0x799c024
y.create.l HWIO_QPIC_QPIC_BAM_P_PRDCR_SDBND6_ADDR A:0x799d024
y.create.l HWIO_QPIC_QPIC_BAM_P_CNSMR_SDBND0_ADDR A:0x7997028
y.create.l HWIO_QPIC_QPIC_BAM_P_CNSMR_SDBND1_ADDR A:0x7998028
y.create.l HWIO_QPIC_QPIC_BAM_P_CNSMR_SDBND2_ADDR A:0x7999028
y.create.l HWIO_QPIC_QPIC_BAM_P_CNSMR_SDBND3_ADDR A:0x799a028
y.create.l HWIO_QPIC_QPIC_BAM_P_CNSMR_SDBND4_ADDR A:0x799b028
y.create.l HWIO_QPIC_QPIC_BAM_P_CNSMR_SDBND5_ADDR A:0x799c028
y.create.l HWIO_QPIC_QPIC_BAM_P_CNSMR_SDBND6_ADDR A:0x799d028
y.create.l HWIO_QPIC_QPIC_BAM_P_SW_OFSTS0_ADDR A:0x7997800
y.create.l HWIO_QPIC_QPIC_BAM_P_SW_OFSTS1_ADDR A:0x7998800
y.create.l HWIO_QPIC_QPIC_BAM_P_SW_OFSTS2_ADDR A:0x7999800
y.create.l HWIO_QPIC_QPIC_BAM_P_SW_OFSTS3_ADDR A:0x799a800
y.create.l HWIO_QPIC_QPIC_BAM_P_SW_OFSTS4_ADDR A:0x799b800
y.create.l HWIO_QPIC_QPIC_BAM_P_SW_OFSTS5_ADDR A:0x799c800
y.create.l HWIO_QPIC_QPIC_BAM_P_SW_OFSTS6_ADDR A:0x799d800
y.create.l HWIO_QPIC_QPIC_BAM_P_AU_PSM_CNTXT_1_0_ADDR A:0x7997804
y.create.l HWIO_QPIC_QPIC_BAM_P_AU_PSM_CNTXT_1_1_ADDR A:0x7998804
y.create.l HWIO_QPIC_QPIC_BAM_P_AU_PSM_CNTXT_1_2_ADDR A:0x7999804
y.create.l HWIO_QPIC_QPIC_BAM_P_AU_PSM_CNTXT_1_3_ADDR A:0x799a804
y.create.l HWIO_QPIC_QPIC_BAM_P_AU_PSM_CNTXT_1_4_ADDR A:0x799b804
y.create.l HWIO_QPIC_QPIC_BAM_P_AU_PSM_CNTXT_1_5_ADDR A:0x799c804
y.create.l HWIO_QPIC_QPIC_BAM_P_AU_PSM_CNTXT_1_6_ADDR A:0x799d804
y.create.l HWIO_QPIC_QPIC_BAM_P_PSM_CNTXT_2_0_ADDR A:0x7997808
y.create.l HWIO_QPIC_QPIC_BAM_P_PSM_CNTXT_2_1_ADDR A:0x7998808
y.create.l HWIO_QPIC_QPIC_BAM_P_PSM_CNTXT_2_2_ADDR A:0x7999808
y.create.l HWIO_QPIC_QPIC_BAM_P_PSM_CNTXT_2_3_ADDR A:0x799a808
y.create.l HWIO_QPIC_QPIC_BAM_P_PSM_CNTXT_2_4_ADDR A:0x799b808
y.create.l HWIO_QPIC_QPIC_BAM_P_PSM_CNTXT_2_5_ADDR A:0x799c808
y.create.l HWIO_QPIC_QPIC_BAM_P_PSM_CNTXT_2_6_ADDR A:0x799d808
y.create.l HWIO_QPIC_QPIC_BAM_P_PSM_CNTXT_3_0_ADDR A:0x799780c
y.create.l HWIO_QPIC_QPIC_BAM_P_PSM_CNTXT_3_1_ADDR A:0x799880c
y.create.l HWIO_QPIC_QPIC_BAM_P_PSM_CNTXT_3_2_ADDR A:0x799980c
y.create.l HWIO_QPIC_QPIC_BAM_P_PSM_CNTXT_3_3_ADDR A:0x799a80c
y.create.l HWIO_QPIC_QPIC_BAM_P_PSM_CNTXT_3_4_ADDR A:0x799b80c
y.create.l HWIO_QPIC_QPIC_BAM_P_PSM_CNTXT_3_5_ADDR A:0x799c80c
y.create.l HWIO_QPIC_QPIC_BAM_P_PSM_CNTXT_3_6_ADDR A:0x799d80c
y.create.l HWIO_QPIC_QPIC_BAM_P_PSM_CNTXT_4_0_ADDR A:0x7997810
y.create.l HWIO_QPIC_QPIC_BAM_P_PSM_CNTXT_4_1_ADDR A:0x7998810
y.create.l HWIO_QPIC_QPIC_BAM_P_PSM_CNTXT_4_2_ADDR A:0x7999810
y.create.l HWIO_QPIC_QPIC_BAM_P_PSM_CNTXT_4_3_ADDR A:0x799a810
y.create.l HWIO_QPIC_QPIC_BAM_P_PSM_CNTXT_4_4_ADDR A:0x799b810
y.create.l HWIO_QPIC_QPIC_BAM_P_PSM_CNTXT_4_5_ADDR A:0x799c810
y.create.l HWIO_QPIC_QPIC_BAM_P_PSM_CNTXT_4_6_ADDR A:0x799d810
y.create.l HWIO_QPIC_QPIC_BAM_P_PSM_CNTXT_5_0_ADDR A:0x7997814
y.create.l HWIO_QPIC_QPIC_BAM_P_PSM_CNTXT_5_1_ADDR A:0x7998814
y.create.l HWIO_QPIC_QPIC_BAM_P_PSM_CNTXT_5_2_ADDR A:0x7999814
y.create.l HWIO_QPIC_QPIC_BAM_P_PSM_CNTXT_5_3_ADDR A:0x799a814
y.create.l HWIO_QPIC_QPIC_BAM_P_PSM_CNTXT_5_4_ADDR A:0x799b814
y.create.l HWIO_QPIC_QPIC_BAM_P_PSM_CNTXT_5_5_ADDR A:0x799c814
y.create.l HWIO_QPIC_QPIC_BAM_P_PSM_CNTXT_5_6_ADDR A:0x799d814
y.create.l HWIO_QPIC_QPIC_BAM_P_EVNT_REG0_ADDR A:0x7997818
y.create.l HWIO_QPIC_QPIC_BAM_P_EVNT_REG1_ADDR A:0x7998818
y.create.l HWIO_QPIC_QPIC_BAM_P_EVNT_REG2_ADDR A:0x7999818
y.create.l HWIO_QPIC_QPIC_BAM_P_EVNT_REG3_ADDR A:0x799a818
y.create.l HWIO_QPIC_QPIC_BAM_P_EVNT_REG4_ADDR A:0x799b818
y.create.l HWIO_QPIC_QPIC_BAM_P_EVNT_REG5_ADDR A:0x799c818
y.create.l HWIO_QPIC_QPIC_BAM_P_EVNT_REG6_ADDR A:0x799d818
y.create.l HWIO_QPIC_QPIC_BAM_P_DESC_FIFO_ADDR0_ADDR A:0x799781c
y.create.l HWIO_QPIC_QPIC_BAM_P_DESC_FIFO_ADDR1_ADDR A:0x799881c
y.create.l HWIO_QPIC_QPIC_BAM_P_DESC_FIFO_ADDR2_ADDR A:0x799981c
y.create.l HWIO_QPIC_QPIC_BAM_P_DESC_FIFO_ADDR3_ADDR A:0x799a81c
y.create.l HWIO_QPIC_QPIC_BAM_P_DESC_FIFO_ADDR4_ADDR A:0x799b81c
y.create.l HWIO_QPIC_QPIC_BAM_P_DESC_FIFO_ADDR5_ADDR A:0x799c81c
y.create.l HWIO_QPIC_QPIC_BAM_P_DESC_FIFO_ADDR6_ADDR A:0x799d81c
y.create.l HWIO_QPIC_QPIC_BAM_P_FIFO_SIZES0_ADDR A:0x7997820
y.create.l HWIO_QPIC_QPIC_BAM_P_FIFO_SIZES1_ADDR A:0x7998820
y.create.l HWIO_QPIC_QPIC_BAM_P_FIFO_SIZES2_ADDR A:0x7999820
y.create.l HWIO_QPIC_QPIC_BAM_P_FIFO_SIZES3_ADDR A:0x799a820
y.create.l HWIO_QPIC_QPIC_BAM_P_FIFO_SIZES4_ADDR A:0x799b820
y.create.l HWIO_QPIC_QPIC_BAM_P_FIFO_SIZES5_ADDR A:0x799c820
y.create.l HWIO_QPIC_QPIC_BAM_P_FIFO_SIZES6_ADDR A:0x799d820
y.create.l HWIO_QPIC_QPIC_BAM_P_DATA_FIFO_ADDR0_ADDR A:0x7997824
y.create.l HWIO_QPIC_QPIC_BAM_P_DATA_FIFO_ADDR1_ADDR A:0x7998824
y.create.l HWIO_QPIC_QPIC_BAM_P_DATA_FIFO_ADDR2_ADDR A:0x7999824
y.create.l HWIO_QPIC_QPIC_BAM_P_DATA_FIFO_ADDR3_ADDR A:0x799a824
y.create.l HWIO_QPIC_QPIC_BAM_P_DATA_FIFO_ADDR4_ADDR A:0x799b824
y.create.l HWIO_QPIC_QPIC_BAM_P_DATA_FIFO_ADDR5_ADDR A:0x799c824
y.create.l HWIO_QPIC_QPIC_BAM_P_DATA_FIFO_ADDR6_ADDR A:0x799d824
y.create.l HWIO_QPIC_QPIC_BAM_P_EVNT_GEN_TRSHLD0_ADDR A:0x7997828
y.create.l HWIO_QPIC_QPIC_BAM_P_EVNT_GEN_TRSHLD1_ADDR A:0x7998828
y.create.l HWIO_QPIC_QPIC_BAM_P_EVNT_GEN_TRSHLD2_ADDR A:0x7999828
y.create.l HWIO_QPIC_QPIC_BAM_P_EVNT_GEN_TRSHLD3_ADDR A:0x799a828
y.create.l HWIO_QPIC_QPIC_BAM_P_EVNT_GEN_TRSHLD4_ADDR A:0x799b828
y.create.l HWIO_QPIC_QPIC_BAM_P_EVNT_GEN_TRSHLD5_ADDR A:0x799c828
y.create.l HWIO_QPIC_QPIC_BAM_P_EVNT_GEN_TRSHLD6_ADDR A:0x799d828
y.create.l HWIO_QPIC_QPIC_BAM_P_EVNT_DEST_ADDR0_ADDR A:0x799782c
y.create.l HWIO_QPIC_QPIC_BAM_P_EVNT_DEST_ADDR1_ADDR A:0x799882c
y.create.l HWIO_QPIC_QPIC_BAM_P_EVNT_DEST_ADDR2_ADDR A:0x799982c
y.create.l HWIO_QPIC_QPIC_BAM_P_EVNT_DEST_ADDR3_ADDR A:0x799a82c
y.create.l HWIO_QPIC_QPIC_BAM_P_EVNT_DEST_ADDR4_ADDR A:0x799b82c
y.create.l HWIO_QPIC_QPIC_BAM_P_EVNT_DEST_ADDR5_ADDR A:0x799c82c
y.create.l HWIO_QPIC_QPIC_BAM_P_EVNT_DEST_ADDR6_ADDR A:0x799d82c
y.create.l HWIO_QPIC_QPIC_BAM_P_DF_CNTXT_0_ADDR A:0x7997830
y.create.l HWIO_QPIC_QPIC_BAM_P_DF_CNTXT_1_ADDR A:0x7998830
y.create.l HWIO_QPIC_QPIC_BAM_P_DF_CNTXT_2_ADDR A:0x7999830
y.create.l HWIO_QPIC_QPIC_BAM_P_DF_CNTXT_3_ADDR A:0x799a830
y.create.l HWIO_QPIC_QPIC_BAM_P_DF_CNTXT_4_ADDR A:0x799b830
y.create.l HWIO_QPIC_QPIC_BAM_P_DF_CNTXT_5_ADDR A:0x799c830
y.create.l HWIO_QPIC_QPIC_BAM_P_DF_CNTXT_6_ADDR A:0x799d830
y.create.l HWIO_QPIC_QPIC_BAM_P_RETR_CNTXT_0_ADDR A:0x7997834
y.create.l HWIO_QPIC_QPIC_BAM_P_RETR_CNTXT_1_ADDR A:0x7998834
y.create.l HWIO_QPIC_QPIC_BAM_P_RETR_CNTXT_2_ADDR A:0x7999834
y.create.l HWIO_QPIC_QPIC_BAM_P_RETR_CNTXT_3_ADDR A:0x799a834
y.create.l HWIO_QPIC_QPIC_BAM_P_RETR_CNTXT_4_ADDR A:0x799b834
y.create.l HWIO_QPIC_QPIC_BAM_P_RETR_CNTXT_5_ADDR A:0x799c834
y.create.l HWIO_QPIC_QPIC_BAM_P_RETR_CNTXT_6_ADDR A:0x799d834
y.create.l HWIO_QPIC_QPIC_BAM_P_SI_CNTXT_0_ADDR A:0x7997838
y.create.l HWIO_QPIC_QPIC_BAM_P_SI_CNTXT_1_ADDR A:0x7998838
y.create.l HWIO_QPIC_QPIC_BAM_P_SI_CNTXT_2_ADDR A:0x7999838
y.create.l HWIO_QPIC_QPIC_BAM_P_SI_CNTXT_3_ADDR A:0x799a838
y.create.l HWIO_QPIC_QPIC_BAM_P_SI_CNTXT_4_ADDR A:0x799b838
y.create.l HWIO_QPIC_QPIC_BAM_P_SI_CNTXT_5_ADDR A:0x799c838
y.create.l HWIO_QPIC_QPIC_BAM_P_SI_CNTXT_6_ADDR A:0x799d838
y.create.l HWIO_QPIC_QPIC_BAM_P_PSM_CNTXT_3_LSB0_ADDR A:0x7997900
y.create.l HWIO_QPIC_QPIC_BAM_P_PSM_CNTXT_3_LSB1_ADDR A:0x7998900
y.create.l HWIO_QPIC_QPIC_BAM_P_PSM_CNTXT_3_LSB2_ADDR A:0x7999900
y.create.l HWIO_QPIC_QPIC_BAM_P_PSM_CNTXT_3_LSB3_ADDR A:0x799a900
y.create.l HWIO_QPIC_QPIC_BAM_P_PSM_CNTXT_3_LSB4_ADDR A:0x799b900
y.create.l HWIO_QPIC_QPIC_BAM_P_PSM_CNTXT_3_LSB5_ADDR A:0x799c900
y.create.l HWIO_QPIC_QPIC_BAM_P_PSM_CNTXT_3_LSB6_ADDR A:0x799d900
y.create.l HWIO_QPIC_QPIC_BAM_P_PSM_CNTXT_3_MSB0_ADDR A:0x7997904
y.create.l HWIO_QPIC_QPIC_BAM_P_PSM_CNTXT_3_MSB1_ADDR A:0x7998904
y.create.l HWIO_QPIC_QPIC_BAM_P_PSM_CNTXT_3_MSB2_ADDR A:0x7999904
y.create.l HWIO_QPIC_QPIC_BAM_P_PSM_CNTXT_3_MSB3_ADDR A:0x799a904
y.create.l HWIO_QPIC_QPIC_BAM_P_PSM_CNTXT_3_MSB4_ADDR A:0x799b904
y.create.l HWIO_QPIC_QPIC_BAM_P_PSM_CNTXT_3_MSB5_ADDR A:0x799c904
y.create.l HWIO_QPIC_QPIC_BAM_P_PSM_CNTXT_3_MSB6_ADDR A:0x799d904
y.create.l HWIO_QPIC_QPIC_BAM_P_DESC_FIFO_ADDR_LSB0_ADDR A:0x7997910
y.create.l HWIO_QPIC_QPIC_BAM_P_DESC_FIFO_ADDR_LSB1_ADDR A:0x7998910
y.create.l HWIO_QPIC_QPIC_BAM_P_DESC_FIFO_ADDR_LSB2_ADDR A:0x7999910
y.create.l HWIO_QPIC_QPIC_BAM_P_DESC_FIFO_ADDR_LSB3_ADDR A:0x799a910
y.create.l HWIO_QPIC_QPIC_BAM_P_DESC_FIFO_ADDR_LSB4_ADDR A:0x799b910
y.create.l HWIO_QPIC_QPIC_BAM_P_DESC_FIFO_ADDR_LSB5_ADDR A:0x799c910
y.create.l HWIO_QPIC_QPIC_BAM_P_DESC_FIFO_ADDR_LSB6_ADDR A:0x799d910
y.create.l HWIO_QPIC_QPIC_BAM_P_DESC_FIFO_ADDR_MSB0_ADDR A:0x7997914
y.create.l HWIO_QPIC_QPIC_BAM_P_DESC_FIFO_ADDR_MSB1_ADDR A:0x7998914
y.create.l HWIO_QPIC_QPIC_BAM_P_DESC_FIFO_ADDR_MSB2_ADDR A:0x7999914
y.create.l HWIO_QPIC_QPIC_BAM_P_DESC_FIFO_ADDR_MSB3_ADDR A:0x799a914
y.create.l HWIO_QPIC_QPIC_BAM_P_DESC_FIFO_ADDR_MSB4_ADDR A:0x799b914
y.create.l HWIO_QPIC_QPIC_BAM_P_DESC_FIFO_ADDR_MSB5_ADDR A:0x799c914
y.create.l HWIO_QPIC_QPIC_BAM_P_DESC_FIFO_ADDR_MSB6_ADDR A:0x799d914
y.create.l HWIO_QPIC_QPIC_BAM_P_DATA_FIFO_ADDR_LSB0_ADDR A:0x7997920
y.create.l HWIO_QPIC_QPIC_BAM_P_DATA_FIFO_ADDR_LSB1_ADDR A:0x7998920
y.create.l HWIO_QPIC_QPIC_BAM_P_DATA_FIFO_ADDR_LSB2_ADDR A:0x7999920
y.create.l HWIO_QPIC_QPIC_BAM_P_DATA_FIFO_ADDR_LSB3_ADDR A:0x799a920
y.create.l HWIO_QPIC_QPIC_BAM_P_DATA_FIFO_ADDR_LSB4_ADDR A:0x799b920
y.create.l HWIO_QPIC_QPIC_BAM_P_DATA_FIFO_ADDR_LSB5_ADDR A:0x799c920
y.create.l HWIO_QPIC_QPIC_BAM_P_DATA_FIFO_ADDR_LSB6_ADDR A:0x799d920
y.create.l HWIO_QPIC_QPIC_BAM_P_DATA_FIFO_ADDR_MSB0_ADDR A:0x7997924
y.create.l HWIO_QPIC_QPIC_BAM_P_DATA_FIFO_ADDR_MSB1_ADDR A:0x7998924
y.create.l HWIO_QPIC_QPIC_BAM_P_DATA_FIFO_ADDR_MSB2_ADDR A:0x7999924
y.create.l HWIO_QPIC_QPIC_BAM_P_DATA_FIFO_ADDR_MSB3_ADDR A:0x799a924
y.create.l HWIO_QPIC_QPIC_BAM_P_DATA_FIFO_ADDR_MSB4_ADDR A:0x799b924
y.create.l HWIO_QPIC_QPIC_BAM_P_DATA_FIFO_ADDR_MSB5_ADDR A:0x799c924
y.create.l HWIO_QPIC_QPIC_BAM_P_DATA_FIFO_ADDR_MSB6_ADDR A:0x799d924
y.create.l HWIO_QPIC_QPIC_BAM_P_EVNT_DEST_ADDR_LSB0_ADDR A:0x7997930
y.create.l HWIO_QPIC_QPIC_BAM_P_EVNT_DEST_ADDR_LSB1_ADDR A:0x7998930
y.create.l HWIO_QPIC_QPIC_BAM_P_EVNT_DEST_ADDR_LSB2_ADDR A:0x7999930
y.create.l HWIO_QPIC_QPIC_BAM_P_EVNT_DEST_ADDR_LSB3_ADDR A:0x799a930
y.create.l HWIO_QPIC_QPIC_BAM_P_EVNT_DEST_ADDR_LSB4_ADDR A:0x799b930
y.create.l HWIO_QPIC_QPIC_BAM_P_EVNT_DEST_ADDR_LSB5_ADDR A:0x799c930
y.create.l HWIO_QPIC_QPIC_BAM_P_EVNT_DEST_ADDR_LSB6_ADDR A:0x799d930
y.create.l HWIO_QPIC_QPIC_BAM_P_EVNT_DEST_ADDR_MSB0_ADDR A:0x7997934
y.create.l HWIO_QPIC_QPIC_BAM_P_EVNT_DEST_ADDR_MSB1_ADDR A:0x7998934
y.create.l HWIO_QPIC_QPIC_BAM_P_EVNT_DEST_ADDR_MSB2_ADDR A:0x7999934
y.create.l HWIO_QPIC_QPIC_BAM_P_EVNT_DEST_ADDR_MSB3_ADDR A:0x799a934
y.create.l HWIO_QPIC_QPIC_BAM_P_EVNT_DEST_ADDR_MSB4_ADDR A:0x799b934
y.create.l HWIO_QPIC_QPIC_BAM_P_EVNT_DEST_ADDR_MSB5_ADDR A:0x799c934
y.create.l HWIO_QPIC_QPIC_BAM_P_EVNT_DEST_ADDR_MSB6_ADDR A:0x799d934
y.create.l HWIO_QPIC_QPIC_XPU_SCR_ADDR A:0x7982000
y.create.l HWIO_QPIC_QPIC_XPU_SWDR_ADDR A:0x7982004
y.create.l HWIO_QPIC_QPIC_XPU_SEAR0_ADDR A:0x7982040
y.create.l HWIO_QPIC_QPIC_XPU_SESR_ADDR A:0x7982048
y.create.l HWIO_QPIC_QPIC_XPU_SESRRESTORE_ADDR A:0x798204c
y.create.l HWIO_QPIC_QPIC_XPU_SESYNR0_ADDR A:0x7982050
y.create.l HWIO_QPIC_QPIC_XPU_SESYNR1_ADDR A:0x7982054
y.create.l HWIO_QPIC_QPIC_XPU_SESYNR2_ADDR A:0x7982058
y.create.l HWIO_QPIC_QPIC_XPU_MCR_ADDR A:0x7982100
y.create.l HWIO_QPIC_QPIC_XPU_MEAR0_ADDR A:0x7982140
y.create.l HWIO_QPIC_QPIC_XPU_MESR_ADDR A:0x7982148
y.create.l HWIO_QPIC_QPIC_XPU_MESRRESTORE_ADDR A:0x798214c
y.create.l HWIO_QPIC_QPIC_XPU_MESYNR0_ADDR A:0x7982150
y.create.l HWIO_QPIC_QPIC_XPU_MESYNR1_ADDR A:0x7982154
y.create.l HWIO_QPIC_QPIC_XPU_MESYNR2_ADDR A:0x7982158
y.create.l HWIO_QPIC_QPIC_XPU_CR_ADDR A:0x7982080
y.create.l HWIO_QPIC_QPIC_XPU_RPU_ACR0_ADDR A:0x79820a0
y.create.l HWIO_QPIC_QPIC_XPU_EAR0_ADDR A:0x79820c0
y.create.l HWIO_QPIC_QPIC_XPU_ESR_ADDR A:0x79820c8
y.create.l HWIO_QPIC_QPIC_XPU_ESRRESTORE_ADDR A:0x79820cc
y.create.l HWIO_QPIC_QPIC_XPU_ESYNR0_ADDR A:0x79820d0
y.create.l HWIO_QPIC_QPIC_XPU_ESYNR1_ADDR A:0x79820d4
y.create.l HWIO_QPIC_QPIC_XPU_ESYNR2_ADDR A:0x79820d8
y.create.l HWIO_QPIC_QPIC_XPU_IDR0_ADDR A:0x7982074
y.create.l HWIO_QPIC_QPIC_XPU_IDR1_ADDR A:0x7982078
y.create.l HWIO_QPIC_QPIC_XPU_REV_ADDR A:0x798207c
y.create.l HWIO_QPIC_QPIC_XPU_RG0_RACR0_ADDR A:0x7982200
y.create.l HWIO_QPIC_QPIC_XPU_RG1_RACR0_ADDR A:0x7982280
y.create.l HWIO_QPIC_QPIC_XPU_RG2_RACR0_ADDR A:0x7982300
y.create.l HWIO_QPIC_QPIC_XPU_RG3_RACR0_ADDR A:0x7982380
y.create.l HWIO_QPIC_QPIC_XPU_RG4_RACR0_ADDR A:0x7982400
y.create.l HWIO_QPIC_QPIC_XPU_RG5_RACR0_ADDR A:0x7982480
y.create.l HWIO_QPIC_QPIC_XPU_RG6_RACR0_ADDR A:0x7982500
y.create.l HWIO_QPIC_QPIC_XPU_RG7_RACR0_ADDR A:0x7982580
y.create.l HWIO_QPIC_QPIC_XPU_RG8_RACR0_ADDR A:0x7982600
y.create.l HWIO_QPIC_QPIC_XPU_RG9_RACR0_ADDR A:0x7982680
y.create.l HWIO_QPIC_QPIC_XPU_RG0_SCR_ADDR A:0x7982250
y.create.l HWIO_QPIC_QPIC_XPU_RG1_SCR_ADDR A:0x79822d0
y.create.l HWIO_QPIC_QPIC_XPU_RG2_SCR_ADDR A:0x7982350
y.create.l HWIO_QPIC_QPIC_XPU_RG3_SCR_ADDR A:0x79823d0
y.create.l HWIO_QPIC_QPIC_XPU_RG4_SCR_ADDR A:0x7982450
y.create.l HWIO_QPIC_QPIC_XPU_RG5_SCR_ADDR A:0x79824d0
y.create.l HWIO_QPIC_QPIC_XPU_RG6_SCR_ADDR A:0x7982550
y.create.l HWIO_QPIC_QPIC_XPU_RG7_SCR_ADDR A:0x79825d0
y.create.l HWIO_QPIC_QPIC_XPU_RG8_SCR_ADDR A:0x7982650
y.create.l HWIO_QPIC_QPIC_XPU_RG9_SCR_ADDR A:0x79826d0
y.create.l HWIO_QPIC_QPIC_XPU_RG0_MCR_ADDR A:0x7982254
y.create.l HWIO_QPIC_QPIC_XPU_RG1_MCR_ADDR A:0x79822d4
y.create.l HWIO_QPIC_QPIC_XPU_RG2_MCR_ADDR A:0x7982354
y.create.l HWIO_QPIC_QPIC_XPU_RG3_MCR_ADDR A:0x79823d4
y.create.l HWIO_QPIC_QPIC_XPU_RG4_MCR_ADDR A:0x7982454
y.create.l HWIO_QPIC_QPIC_XPU_RG5_MCR_ADDR A:0x79824d4
y.create.l HWIO_QPIC_QPIC_XPU_RG6_MCR_ADDR A:0x7982554
y.create.l HWIO_QPIC_QPIC_XPU_RG7_MCR_ADDR A:0x79825d4
y.create.l HWIO_QPIC_QPIC_XPU_RG8_MCR_ADDR A:0x7982654
y.create.l HWIO_QPIC_QPIC_XPU_RG9_MCR_ADDR A:0x79826d4
y.create.l HWIO_QPIC_QPIC_VMIDMT_SCR0_ADDR A:0x7980000
y.create.l HWIO_QPIC_QPIC_VMIDMT_SCR1_ADDR A:0x7980004
y.create.l HWIO_QPIC_QPIC_VMIDMT_SCR2_ADDR A:0x7980008
y.create.l HWIO_QPIC_QPIC_VMIDMT_SACR_ADDR A:0x7980010
y.create.l HWIO_QPIC_QPIC_VMIDMT_SIDR0_ADDR A:0x7980020
y.create.l HWIO_QPIC_QPIC_VMIDMT_SIDR1_ADDR A:0x7980024
y.create.l HWIO_QPIC_QPIC_VMIDMT_SIDR2_ADDR A:0x7980028
y.create.l HWIO_QPIC_QPIC_VMIDMT_SIDR4_ADDR A:0x7980030
y.create.l HWIO_QPIC_QPIC_VMIDMT_SIDR5_ADDR A:0x7980034
y.create.l HWIO_QPIC_QPIC_VMIDMT_SIDR7_ADDR A:0x798003c
y.create.l HWIO_QPIC_QPIC_VMIDMT_SGFAR0_ADDR A:0x7980040
y.create.l HWIO_QPIC_QPIC_VMIDMT_SGFSR_ADDR A:0x7980048
y.create.l HWIO_QPIC_QPIC_VMIDMT_SGFSRRESTORE_ADDR A:0x798004c
y.create.l HWIO_QPIC_QPIC_VMIDMT_SGFSYNDR0_ADDR A:0x7980050
y.create.l HWIO_QPIC_QPIC_VMIDMT_SGFSYNDR1_ADDR A:0x7980054
y.create.l HWIO_QPIC_QPIC_VMIDMT_SGFSYNDR2_ADDR A:0x7980058
y.create.l HWIO_QPIC_QPIC_VMIDMT_VMIDMTSCR0_ADDR A:0x7980090
y.create.l HWIO_QPIC_QPIC_VMIDMT_CR0_ADDR A:0x7980000
y.create.l HWIO_QPIC_QPIC_VMIDMT_CR2_ADDR A:0x7980008
y.create.l HWIO_QPIC_QPIC_VMIDMT_ACR_ADDR A:0x7980010
y.create.l HWIO_QPIC_QPIC_VMIDMT_IDR0_ADDR A:0x7980020
y.create.l HWIO_QPIC_QPIC_VMIDMT_IDR1_ADDR A:0x7980024
y.create.l HWIO_QPIC_QPIC_VMIDMT_IDR2_ADDR A:0x7980028
y.create.l HWIO_QPIC_QPIC_VMIDMT_IDR4_ADDR A:0x7980030
y.create.l HWIO_QPIC_QPIC_VMIDMT_IDR5_ADDR A:0x7980034
y.create.l HWIO_QPIC_QPIC_VMIDMT_IDR7_ADDR A:0x798003c
y.create.l HWIO_QPIC_QPIC_VMIDMT_GFAR0_ADDR A:0x7980040
y.create.l HWIO_QPIC_QPIC_VMIDMT_GFSR_ADDR A:0x7980048
y.create.l HWIO_QPIC_QPIC_VMIDMT_GFSRRESTORE_ADDR A:0x798004c
y.create.l HWIO_QPIC_QPIC_VMIDMT_GFSYNDR0_ADDR A:0x7980050
y.create.l HWIO_QPIC_QPIC_VMIDMT_GFSYNDR1_ADDR A:0x7980054
y.create.l HWIO_QPIC_QPIC_VMIDMT_GFSYNDR2_ADDR A:0x7980058
y.create.l HWIO_QPIC_QPIC_VMIDMT_VMIDMTCR0_ADDR A:0x7980090
y.create.l HWIO_QPIC_QPIC_VMIDMT_VMIDMTACR_ADDR A:0x798009c
y.create.l HWIO_QPIC_QPIC_VMIDMT_NSCR0_ADDR A:0x7980400
y.create.l HWIO_QPIC_QPIC_VMIDMT_NSCR2_ADDR A:0x7980408
y.create.l HWIO_QPIC_QPIC_VMIDMT_NSACR_ADDR A:0x7980410
y.create.l HWIO_QPIC_QPIC_VMIDMT_NSGFAR0_ADDR A:0x7980440
y.create.l HWIO_QPIC_QPIC_VMIDMT_NSGFSR_ADDR A:0x7980448
y.create.l HWIO_QPIC_QPIC_VMIDMT_NSGFSRRESTORE_ADDR A:0x798044c
y.create.l HWIO_QPIC_QPIC_VMIDMT_NSGFSYNDR0_ADDR A:0x7980450
y.create.l HWIO_QPIC_QPIC_VMIDMT_NSGFSYNDR1_ADDR A:0x7980454
y.create.l HWIO_QPIC_QPIC_VMIDMT_NSGFSYNDR2_ADDR A:0x7980458
y.create.l HWIO_QPIC_QPIC_VMIDMT_NSVMIDMTCR0_ADDR A:0x7980490
y.create.l HWIO_QPIC_QPIC_VMIDMT_SSDR0_ADDR A:0x7980080
y.create.l HWIO_QPIC_QPIC_VMIDMT_MSDR0_ADDR A:0x7980480
y.create.l HWIO_QPIC_QPIC_VMIDMT_MCR_ADDR A:0x7980494
y.create.l HWIO_QPIC_QPIC_VMIDMT_S2VR0_ADDR A:0x7980c00
y.create.l HWIO_QPIC_QPIC_VMIDMT_S2VR1_ADDR A:0x7980c04
y.create.l HWIO_QPIC_QPIC_VMIDMT_S2VR2_ADDR A:0x7980c08
y.create.l HWIO_QPIC_QPIC_VMIDMT_S2VR3_ADDR A:0x7980c0c
y.create.l HWIO_QPIC_QPIC_VMIDMT_S2VR4_ADDR A:0x7980c10
y.create.l HWIO_QPIC_QPIC_VMIDMT_S2VR5_ADDR A:0x7980c14
y.create.l HWIO_QPIC_QPIC_VMIDMT_S2VR6_ADDR A:0x7980c18
y.create.l HWIO_QPIC_QPIC_VMIDMT_S2VR7_ADDR A:0x7980c1c
y.create.l HWIO_QPIC_QPIC_VMIDMT_AS2VR0_ADDR A:0x7980e00
y.create.l HWIO_QPIC_QPIC_VMIDMT_AS2VR1_ADDR A:0x7980e04
y.create.l HWIO_QPIC_QPIC_VMIDMT_AS2VR2_ADDR A:0x7980e08
y.create.l HWIO_QPIC_QPIC_VMIDMT_AS2VR3_ADDR A:0x7980e0c
y.create.l HWIO_QPIC_QPIC_VMIDMT_AS2VR4_ADDR A:0x7980e10
y.create.l HWIO_QPIC_QPIC_VMIDMT_AS2VR5_ADDR A:0x7980e14
y.create.l HWIO_QPIC_QPIC_VMIDMT_AS2VR6_ADDR A:0x7980e18
y.create.l HWIO_QPIC_QPIC_VMIDMT_AS2VR7_ADDR A:0x7980e1c
y.create.l HWIO_QPIC_QPIC_VMIDMT_SMR0_ADDR A:0x7980800
y.create.l HWIO_QPIC_QPIC_VMIDMT_SMR1_ADDR A:0x7980804
y.create.l HWIO_QPIC_QPIC_VMIDMT_SMR2_ADDR A:0x7980808
y.create.l HWIO_QPIC_QPIC_VMIDMT_SMR3_ADDR A:0x798080c
y.create.l HWIO_QPIC_QPIC_VMIDMT_SMR4_ADDR A:0x7980810
y.create.l HWIO_QPIC_QPIC_VMIDMT_SMR5_ADDR A:0x7980814
y.create.l HWIO_QPIC_QPIC_VMIDMT_SMR6_ADDR A:0x7980818
y.create.l HWIO_QPIC_QPIC_VMIDMT_SMR7_ADDR A:0x798081c
y.create.l HWIO_QPIC_EBI2_CHIP_SELECT_CFG0_ADDR A:0x79a6000
y.create.l HWIO_QPIC_EBI2_CFG_ADDR A:0x79a7004
y.create.l HWIO_QPIC_EBI2_ARBITER_CFG_ADDR A:0x79a7030
y.create.l HWIO_QPIC_EBI2_DEBUG_REG_LSB_ADDR A:0x79a4048
y.create.l HWIO_QPIC_EBI2_DEBUG_REG_MSB_ADDR A:0x79a404c
y.create.l HWIO_QPIC_EBI2_DEBUG_SEL_ADDR A:0x79a4050
y.create.l HWIO_QPIC_EBI2_CRC_CFG_ADDR A:0x79a6054
y.create.l HWIO_QPIC_EBI2_CRC_REMINDER_CFG_ADDR A:0x79a6058
y.create.l HWIO_QPIC_EBI2_NAND_ADM_MUX_ADDR A:0x79a605c
y.create.l HWIO_QPIC_EBI2_CLKON_CFG_ADDR A:0x79a7068
y.create.l HWIO_QPIC_EBI2_CORE_CLKON_CFG_ADDR A:0x79a706c
y.create.l HWIO_QPIC_QPIC_LCDC_CTRL_ADDR A:0x79a2000
y.create.l HWIO_QPIC_LCDC_VERSION_ADDR A:0x79a2004
y.create.l HWIO_QPIC_QPIC_LCDC_IRQ_EN_ADDR A:0x79a2008
y.create.l HWIO_QPIC_QPIC_LCDC_IRQ_STTS_ADDR A:0x79a200c
y.create.l HWIO_QPIC_QPIC_LCDC_IRQ_CLR_ADDR A:0x79a2010
y.create.l HWIO_QPIC_QPIC_LCDC_STTS_ADDR A:0x79a2014
y.create.l HWIO_QPIC_QPIC_LCDC_CMD_DATA_CYCLE_CNT_ADDR A:0x79a2018
y.create.l HWIO_QPIC_QPIC_LCDC_CFG0_ADDR A:0x79a2020
y.create.l HWIO_QPIC_QPIC_LCDC_CFG1_ADDR A:0x79a2024
y.create.l HWIO_QPIC_QPIC_LCDC_CFG2_ADDR A:0x79a2028
y.create.l HWIO_QPIC_QPIC_LCDC_RESET_ADDR A:0x79a202c
y.create.l HWIO_QPIC_QPIC_LCD_DEVICE_RESET_ADDR A:0x79a2030
y.create.l HWIO_QPIC_QPIC_LCDC_FIFO_SOF_ADDR A:0x79a2100
y.create.l HWIO_QPIC_QPIC_LCDC_FIFO_DATA_PORT0_ADDR A:0x79a2140
y.create.l HWIO_QPIC_QPIC_LCDC_FIFO_DATA_PORT1_ADDR A:0x79a2144
y.create.l HWIO_QPIC_QPIC_LCDC_FIFO_DATA_PORT2_ADDR A:0x79a2148
y.create.l HWIO_QPIC_QPIC_LCDC_FIFO_DATA_PORT3_ADDR A:0x79a214c
y.create.l HWIO_QPIC_QPIC_LCDC_FIFO_DATA_PORT4_ADDR A:0x79a2150
y.create.l HWIO_QPIC_QPIC_LCDC_FIFO_DATA_PORT5_ADDR A:0x79a2154
y.create.l HWIO_QPIC_QPIC_LCDC_FIFO_DATA_PORT6_ADDR A:0x79a2158
y.create.l HWIO_QPIC_QPIC_LCDC_FIFO_DATA_PORT7_ADDR A:0x79a215c
y.create.l HWIO_QPIC_QPIC_LCDC_FIFO_DATA_PORT8_ADDR A:0x79a2160
y.create.l HWIO_QPIC_QPIC_LCDC_FIFO_DATA_PORT9_ADDR A:0x79a2164
y.create.l HWIO_QPIC_QPIC_LCDC_FIFO_EOF_ADDR A:0x79a2180
y.create.l HWIO_QPIC_LCD_DEVICE_CMD0_ADDR A:0x79a3000
y.create.l HWIO_QPIC_LCD_DEVICE_CMD1_ADDR A:0x79a3004
y.create.l HWIO_QPIC_LCD_DEVICE_CMD2_ADDR A:0x79a3008
y.create.l HWIO_QPIC_LCD_DEVICE_CMD3_ADDR A:0x79a300c
y.create.l HWIO_QPIC_LCD_DEVICE_CMD4_ADDR A:0x79a3010
y.create.l HWIO_QPIC_LCD_DEVICE_CMD5_ADDR A:0x79a3014
y.create.l HWIO_QPIC_LCD_DEVICE_CMD6_ADDR A:0x79a3018
y.create.l HWIO_QPIC_LCD_DEVICE_CMD7_ADDR A:0x79a301c
y.create.l HWIO_QPIC_LCD_DEVICE_CMD8_ADDR A:0x79a3020
y.create.l HWIO_QPIC_LCD_DEVICE_CMD9_ADDR A:0x79a3024
y.create.l HWIO_QPIC_QPIC_VERSION_ADDR A:0x79a4100
y.create.l HWIO_QPIC_QPIC_CTRL_ADDR A:0x79a7104
y.create.l HWIO_QPIC_QPIC_HW_INFO_ADDR A:0x79a4108
y.create.l HWIO_QPIC_QPIC_REG_PERMISSION_ADDR A:0x79a510c
y.create.l HWIO_QPIC_QPIC_DEBUG_ADDR A:0x79a5110
y.create.l HWIO_QPIC_QPIC_HW_GENERICS_ADDR A:0x79a4114
y.create.l HWIO_QPIC_NAND_FLASH_CMD_ADDR A:0x79b0000
y.create.l HWIO_QPIC_NAND_ADDR0_ADDR A:0x79b0004
y.create.l HWIO_QPIC_NAND_ADDR1_ADDR A:0x79b0008
y.create.l HWIO_QPIC_NAND_FLASH_CHIP_SELECT_ADDR A:0x79b000c
y.create.l HWIO_QPIC_NANDC_EXEC_CMD_ADDR A:0x79b0010
y.create.l HWIO_QPIC_NAND_FLASH_STATUS_ADDR A:0x79b0014
y.create.l HWIO_QPIC_NANDC_BUFFER_STATUS_ADDR A:0x79b0018
y.create.l HWIO_QPIC_NAND_DEV0_CFG0_ADDR A:0x79b0020
y.create.l HWIO_QPIC_NAND_DEV1_CFG0_ADDR A:0x79b0030
y.create.l HWIO_QPIC_NAND_DEV0_CFG1_ADDR A:0x79b0024
y.create.l HWIO_QPIC_NAND_DEV1_CFG1_ADDR A:0x79b0034
y.create.l HWIO_QPIC_NAND_DEV0_ECC_CFG_ADDR A:0x79b0028
y.create.l HWIO_QPIC_NAND_DEV1_ECC_CFG_ADDR A:0x79b602c
y.create.l HWIO_QPIC_NAND_FLASH_READ_ID_ADDR A:0x79b0040
y.create.l HWIO_QPIC_NAND_FLASH_READ_ID2_ADDR A:0x79b0048
y.create.l HWIO_QPIC_NAND_FLASH_READ_STATUS_ADDR A:0x79b0044
y.create.l HWIO_QPIC_NAND_FLASH_CONFIG_DATA_ADDR A:0x79b6050
y.create.l HWIO_QPIC_NAND_FLASH_CONFIG_ADDR A:0x79b6054
y.create.l HWIO_QPIC_NAND_FLASH_CONFIG_MODE_ADDR A:0x79b6058
y.create.l HWIO_QPIC_NAND_FLASH_CONFIG_STATUS_ADDR A:0x79b6060
y.create.l HWIO_QPIC_FLASH_MACRO1_REG_ADDR A:0x79b6064
y.create.l HWIO_QPIC_HSDDR_NAND_CFG_ADDR A:0x79b6068
y.create.l HWIO_QPIC_FLASH_XFR_STEP1_ADDR A:0x79b7070
y.create.l HWIO_QPIC_FLASH_XFR_STEP2_ADDR A:0x79b7074
y.create.l HWIO_QPIC_FLASH_XFR_STEP3_ADDR A:0x79b7078
y.create.l HWIO_QPIC_FLASH_XFR_STEP4_ADDR A:0x79b707c
y.create.l HWIO_QPIC_FLASH_XFR_STEP5_ADDR A:0x79b7080
y.create.l HWIO_QPIC_FLASH_XFR_STEP6_ADDR A:0x79b7084
y.create.l HWIO_QPIC_FLASH_XFR_STEP7_ADDR A:0x79b7088
y.create.l HWIO_QPIC_NAND_GENP_REG0_ADDR A:0x79b6090
y.create.l HWIO_QPIC_NAND_GENP_REG1_ADDR A:0x79b6094
y.create.l HWIO_QPIC_NAND_GENP_REG2_ADDR A:0x79b6098
y.create.l HWIO_QPIC_NAND_GENP_REG3_ADDR A:0x79b609c
y.create.l HWIO_QPIC_FLASH_DEV_CMD0_ADDR A:0x79b70a0
y.create.l HWIO_QPIC_FLASH_DEV_CMD1_ADDR A:0x79b70a4
y.create.l HWIO_QPIC_FLASH_DEV_CMD2_ADDR A:0x79b70a8
y.create.l HWIO_QPIC_FLASH_DEV_CMD_VLD_ADDR A:0x79b70ac
y.create.l HWIO_QPIC_NAND_ADDR2_ADDR A:0x79b60c0
y.create.l HWIO_QPIC_NAND_ADDR3_ADDR A:0x79b60c4
y.create.l HWIO_QPIC_NAND_ADDR4_ADDR A:0x79b60c8
y.create.l HWIO_QPIC_NAND_ADDR5_ADDR A:0x79b60cc
y.create.l HWIO_QPIC_FLASH_DEV_CMD3_ADDR A:0x79b70d0
y.create.l HWIO_QPIC_FLASH_DEV_CMD4_ADDR A:0x79b70d4
y.create.l HWIO_QPIC_FLASH_DEV_CMD5_ADDR A:0x79b70d8
y.create.l HWIO_QPIC_FLASH_DEV_CMD6_ADDR A:0x79b70dc
y.create.l HWIO_QPIC_NAND_ADDR6_ADDR A:0x79b60e4
y.create.l HWIO_QPIC_NAND_ERASED_CW_DETECT_CFG_ADDR A:0x79b00e8
y.create.l HWIO_QPIC_NAND_ERASED_CW_DETECT_STATUS_ADDR A:0x79b00ec
y.create.l HWIO_QPIC_EBI2_ECC_BUF_CFG_ADDR A:0x79b00f0
y.create.l HWIO_QPIC_NANDC_DBG_CFG_ADDR A:0x79b40f4
y.create.l HWIO_QPIC_NANDC_HW_PROFILE_CFG_ADDR A:0x79b40f8
y.create.l HWIO_QPIC_FLASH_BUFF0_ACC_ADDR A:0x79b0100
y.create.l HWIO_QPIC_FLASH_BUFF1_ACC_ADDR A:0x79b0104
y.create.l HWIO_QPIC_FLASH_BUFF2_ACC_ADDR A:0x79b0108
y.create.l HWIO_QPIC_FLASH_BUFF3_ACC_ADDR A:0x79b010c
y.create.l HWIO_QPIC_FLASH_BUFF4_ACC_ADDR A:0x79b0110
y.create.l HWIO_QPIC_FLASH_BUFF5_ACC_ADDR A:0x79b0114
y.create.l HWIO_QPIC_FLASH_BUFF6_ACC_ADDR A:0x79b0118
y.create.l HWIO_QPIC_FLASH_BUFF7_ACC_ADDR A:0x79b011c
y.create.l HWIO_QPIC_FLASH_BUFF8_ACC_ADDR A:0x79b0120
y.create.l HWIO_QPIC_FLASH_BUFF9_ACC_ADDR A:0x79b0124
y.create.l HWIO_QPIC_NAND_CTRL_ADDR A:0x79b0f00
y.create.l HWIO_QPIC_NAND_STATUS_ADDR A:0x79b4f04
y.create.l HWIO_QPIC_NAND_VERSION_ADDR A:0x79b4f08
y.create.l HWIO_QPIC_NAND_MPU_BYPASS_ADDR A:0x79b5f44
y.create.l HWIO_QPIC_NAND_DEBUG_ADDR A:0x79b5f0c
y.create.l HWIO_QPIC_NAND_IRQ_STTS_ADDR A:0x79b0f10
y.create.l HWIO_QPIC_NAND_IRQ_CLR_ADDR A:0x79b0f14
y.create.l HWIO_QPIC_NAND_IRQ_EN_ADDR A:0x79b0f18
y.create.l HWIO_QPIC_NAND_MUTEX_ADDR A:0x79b0f1c
y.create.l HWIO_QPIC_NAND_CONFIG_BITS_ADDR A:0x79b7f40
y.create.l HWIO_QPIC_NAND_READ_LOCATION_0_ADDR A:0x79b0f20
y.create.l HWIO_QPIC_NAND_READ_LOCATION_1_ADDR A:0x79b0f24
y.create.l HWIO_QPIC_NAND_READ_LOCATION_2_ADDR A:0x79b0f28
y.create.l HWIO_QPIC_NAND_READ_LOCATION_3_ADDR A:0x79b0f2c
y.create.l HWIO_QPIC_NAND_READ_LOCATION_4_ADDR A:0x79b0f30
y.create.l HWIO_QPIC_NAND_TEST_BUS_LSB_ADDR A:0x79b4f48
y.create.l HWIO_QPIC_NAND_TEST_BUS_MSB_ADDR A:0x79b4f4c
y.create.l HWIO_QPIC_NAND_OP_DONE_CNT_ADDR A:0x79b5f50
y.create.l HWIO_QPIC_NAND_ERR_RESP_TIME_OUT_ADDR A:0x79b7f54
y.create.l HWIO_QPIC_QPIC_MPU_XPU_SCR_ADDR A:0x79b1000
y.create.l HWIO_QPIC_QPIC_MPU_XPU_SWDR_ADDR A:0x79b1004
y.create.l HWIO_QPIC_QPIC_MPU_XPU_PRTN_RACR_SSHADOW_ADDR A:0x79b1008
y.create.l HWIO_QPIC_QPIC_MPU_XPU_PRTN_WACR_SSHADOW_ADDR A:0x79b100c
y.create.l HWIO_QPIC_QPIC_MPU_XPU_PRTN_START_SSHADOW0_ADDR A:0x79b1010
y.create.l HWIO_QPIC_QPIC_MPU_XPU_PRTN_START_SSHADOW1_ADDR A:0x79b1014
y.create.l HWIO_QPIC_QPIC_MPU_XPU_PRTN_END_SSHADOW0_ADDR A:0x79b1018
y.create.l HWIO_QPIC_QPIC_MPU_XPU_PRTN_END_SSHADOW1_ADDR A:0x79b101c
y.create.l HWIO_QPIC_QPIC_MPU_XPU_SEAR0_ADDR A:0x79b1040
y.create.l HWIO_QPIC_QPIC_MPU_XPU_SEAR1_ADDR A:0x79b1044
y.create.l HWIO_QPIC_QPIC_MPU_XPU_SESR_ADDR A:0x79b1048
y.create.l HWIO_QPIC_QPIC_MPU_XPU_SESRRESTORE_ADDR A:0x79b104c
y.create.l HWIO_QPIC_QPIC_MPU_XPU_SESYNR0_ADDR A:0x79b1050
y.create.l HWIO_QPIC_QPIC_MPU_XPU_SESYNR1_ADDR A:0x79b1054
y.create.l HWIO_QPIC_QPIC_MPU_XPU_SESYNR2_ADDR A:0x79b1058
y.create.l HWIO_QPIC_QPIC_MPU_XPU_MCR_ADDR A:0x79b1100
y.create.l HWIO_QPIC_QPIC_MPU_XPU_MEAR0_ADDR A:0x79b1140
y.create.l HWIO_QPIC_QPIC_MPU_XPU_MEAR1_ADDR A:0x79b1144
y.create.l HWIO_QPIC_QPIC_MPU_XPU_MESR_ADDR A:0x79b1148
y.create.l HWIO_QPIC_QPIC_MPU_XPU_MESRRESTORE_ADDR A:0x79b114c
y.create.l HWIO_QPIC_QPIC_MPU_XPU_MESYNR0_ADDR A:0x79b1150
y.create.l HWIO_QPIC_QPIC_MPU_XPU_MESYNR1_ADDR A:0x79b1154
y.create.l HWIO_QPIC_QPIC_MPU_XPU_MESYNR2_ADDR A:0x79b1158
y.create.l HWIO_QPIC_QPIC_MPU_XPU_CR_ADDR A:0x79b1080
y.create.l HWIO_QPIC_QPIC_MPU_XPU_PRTN_RACR_SHADOW_ADDR A:0x79b1088
y.create.l HWIO_QPIC_QPIC_MPU_XPU_PRTN_WACR_SHADOW_ADDR A:0x79b108c
y.create.l HWIO_QPIC_QPIC_MPU_XPU_PRTN_START_SHADOW0_ADDR A:0x79b1090
y.create.l HWIO_QPIC_QPIC_MPU_XPU_PRTN_START_SHADOW1_ADDR A:0x79b1094
y.create.l HWIO_QPIC_QPIC_MPU_XPU_PRTN_END_SHADOW0_ADDR A:0x79b1098
y.create.l HWIO_QPIC_QPIC_MPU_XPU_PRTN_END_SHADOW1_ADDR A:0x79b109c
y.create.l HWIO_QPIC_QPIC_MPU_XPU_RPU_ACR0_ADDR A:0x79b10a0
y.create.l HWIO_QPIC_QPIC_MPU_XPU_EAR0_ADDR A:0x79b10c0
y.create.l HWIO_QPIC_QPIC_MPU_XPU_EAR1_ADDR A:0x79b10c4
y.create.l HWIO_QPIC_QPIC_MPU_XPU_ESR_ADDR A:0x79b10c8
y.create.l HWIO_QPIC_QPIC_MPU_XPU_ESRRESTORE_ADDR A:0x79b10cc
y.create.l HWIO_QPIC_QPIC_MPU_XPU_ESYNR0_ADDR A:0x79b10d0
y.create.l HWIO_QPIC_QPIC_MPU_XPU_ESYNR1_ADDR A:0x79b10d4
y.create.l HWIO_QPIC_QPIC_MPU_XPU_ESYNR2_ADDR A:0x79b10d8
y.create.l HWIO_QPIC_QPIC_MPU_XPU_UMR_RACR_ADDR A:0x79b10e0
y.create.l HWIO_QPIC_QPIC_MPU_XPU_UMR_WACR_ADDR A:0x79b10e4
y.create.l HWIO_QPIC_QPIC_MPU_XPU_UMR_CNTL_ADDR A:0x79b10f0
y.create.l HWIO_QPIC_QPIC_MPU_XPU_IDR0_ADDR A:0x79b1074
y.create.l HWIO_QPIC_QPIC_MPU_XPU_IDR1_ADDR A:0x79b1078
y.create.l HWIO_QPIC_QPIC_MPU_XPU_REV_ADDR A:0x79b107c
y.create.l HWIO_QPIC_QPIC_MPU_XPU_PRT0_RACR0_ADDR A:0x79b1200
y.create.l HWIO_QPIC_QPIC_MPU_XPU_PRT1_RACR0_ADDR A:0x79b1280
y.create.l HWIO_QPIC_QPIC_MPU_XPU_PRT2_RACR0_ADDR A:0x79b1300
y.create.l HWIO_QPIC_QPIC_MPU_XPU_PRT3_RACR0_ADDR A:0x79b1380
y.create.l HWIO_QPIC_QPIC_MPU_XPU_PRT4_RACR0_ADDR A:0x79b1400
y.create.l HWIO_QPIC_QPIC_MPU_XPU_PRT5_RACR0_ADDR A:0x79b1480
y.create.l HWIO_QPIC_QPIC_MPU_XPU_PRT6_RACR0_ADDR A:0x79b1500
y.create.l HWIO_QPIC_QPIC_MPU_XPU_PRT7_RACR0_ADDR A:0x79b1580
y.create.l HWIO_QPIC_QPIC_MPU_XPU_PRT0_WACR0_ADDR A:0x79b1220
y.create.l HWIO_QPIC_QPIC_MPU_XPU_PRT1_WACR0_ADDR A:0x79b12a0
y.create.l HWIO_QPIC_QPIC_MPU_XPU_PRT2_WACR0_ADDR A:0x79b1320
y.create.l HWIO_QPIC_QPIC_MPU_XPU_PRT3_WACR0_ADDR A:0x79b13a0
y.create.l HWIO_QPIC_QPIC_MPU_XPU_PRT4_WACR0_ADDR A:0x79b1420
y.create.l HWIO_QPIC_QPIC_MPU_XPU_PRT5_WACR0_ADDR A:0x79b14a0
y.create.l HWIO_QPIC_QPIC_MPU_XPU_PRT6_WACR0_ADDR A:0x79b1520
y.create.l HWIO_QPIC_QPIC_MPU_XPU_PRT7_WACR0_ADDR A:0x79b15a0
y.create.l HWIO_QPIC_QPIC_MPU_XPU_PRT0_START0_ADDR A:0x79b1240
y.create.l HWIO_QPIC_QPIC_MPU_XPU_PRT1_START0_ADDR A:0x79b12c0
y.create.l HWIO_QPIC_QPIC_MPU_XPU_PRT2_START0_ADDR A:0x79b1340
y.create.l HWIO_QPIC_QPIC_MPU_XPU_PRT3_START0_ADDR A:0x79b13c0
y.create.l HWIO_QPIC_QPIC_MPU_XPU_PRT4_START0_ADDR A:0x79b1440
y.create.l HWIO_QPIC_QPIC_MPU_XPU_PRT5_START0_ADDR A:0x79b14c0
y.create.l HWIO_QPIC_QPIC_MPU_XPU_PRT6_START0_ADDR A:0x79b1540
y.create.l HWIO_QPIC_QPIC_MPU_XPU_PRT7_START0_ADDR A:0x79b15c0
y.create.l HWIO_QPIC_QPIC_MPU_XPU_PRT0_START1_ADDR A:0x79b1244
y.create.l HWIO_QPIC_QPIC_MPU_XPU_PRT1_START1_ADDR A:0x79b12c4
y.create.l HWIO_QPIC_QPIC_MPU_XPU_PRT2_START1_ADDR A:0x79b1344
y.create.l HWIO_QPIC_QPIC_MPU_XPU_PRT3_START1_ADDR A:0x79b13c4
y.create.l HWIO_QPIC_QPIC_MPU_XPU_PRT4_START1_ADDR A:0x79b1444
y.create.l HWIO_QPIC_QPIC_MPU_XPU_PRT5_START1_ADDR A:0x79b14c4
y.create.l HWIO_QPIC_QPIC_MPU_XPU_PRT6_START1_ADDR A:0x79b1544
y.create.l HWIO_QPIC_QPIC_MPU_XPU_PRT7_START1_ADDR A:0x79b15c4
y.create.l HWIO_QPIC_QPIC_MPU_XPU_PRT0_END0_ADDR A:0x79b1248
y.create.l HWIO_QPIC_QPIC_MPU_XPU_PRT1_END0_ADDR A:0x79b12c8
y.create.l HWIO_QPIC_QPIC_MPU_XPU_PRT2_END0_ADDR A:0x79b1348
y.create.l HWIO_QPIC_QPIC_MPU_XPU_PRT3_END0_ADDR A:0x79b13c8
y.create.l HWIO_QPIC_QPIC_MPU_XPU_PRT4_END0_ADDR A:0x79b1448
y.create.l HWIO_QPIC_QPIC_MPU_XPU_PRT5_END0_ADDR A:0x79b14c8
y.create.l HWIO_QPIC_QPIC_MPU_XPU_PRT6_END0_ADDR A:0x79b1548
y.create.l HWIO_QPIC_QPIC_MPU_XPU_PRT7_END0_ADDR A:0x79b15c8
y.create.l HWIO_QPIC_QPIC_MPU_XPU_PRT0_END1_ADDR A:0x79b124c
y.create.l HWIO_QPIC_QPIC_MPU_XPU_PRT1_END1_ADDR A:0x79b12cc
y.create.l HWIO_QPIC_QPIC_MPU_XPU_PRT2_END1_ADDR A:0x79b134c
y.create.l HWIO_QPIC_QPIC_MPU_XPU_PRT3_END1_ADDR A:0x79b13cc
y.create.l HWIO_QPIC_QPIC_MPU_XPU_PRT4_END1_ADDR A:0x79b144c
y.create.l HWIO_QPIC_QPIC_MPU_XPU_PRT5_END1_ADDR A:0x79b14cc
y.create.l HWIO_QPIC_QPIC_MPU_XPU_PRT6_END1_ADDR A:0x79b154c
y.create.l HWIO_QPIC_QPIC_MPU_XPU_PRT7_END1_ADDR A:0x79b15cc
y.create.l HWIO_QPIC_QPIC_MPU_XPU_PRT0_SCR_ADDR A:0x79b1250
y.create.l HWIO_QPIC_QPIC_MPU_XPU_PRT1_SCR_ADDR A:0x79b12d0
y.create.l HWIO_QPIC_QPIC_MPU_XPU_PRT2_SCR_ADDR A:0x79b1350
y.create.l HWIO_QPIC_QPIC_MPU_XPU_PRT3_SCR_ADDR A:0x79b13d0
y.create.l HWIO_QPIC_QPIC_MPU_XPU_PRT4_SCR_ADDR A:0x79b1450
y.create.l HWIO_QPIC_QPIC_MPU_XPU_PRT5_SCR_ADDR A:0x79b14d0
y.create.l HWIO_QPIC_QPIC_MPU_XPU_PRT6_SCR_ADDR A:0x79b1550
y.create.l HWIO_QPIC_QPIC_MPU_XPU_PRT7_SCR_ADDR A:0x79b15d0
y.create.l HWIO_QPIC_QPIC_MPU_XPU_PRT0_MCR_ADDR A:0x79b1254
y.create.l HWIO_QPIC_QPIC_MPU_XPU_PRT1_MCR_ADDR A:0x79b12d4
y.create.l HWIO_QPIC_QPIC_MPU_XPU_PRT2_MCR_ADDR A:0x79b1354
y.create.l HWIO_QPIC_QPIC_MPU_XPU_PRT3_MCR_ADDR A:0x79b13d4
y.create.l HWIO_QPIC_QPIC_MPU_XPU_PRT4_MCR_ADDR A:0x79b1454
y.create.l HWIO_QPIC_QPIC_MPU_XPU_PRT5_MCR_ADDR A:0x79b14d4
y.create.l HWIO_QPIC_QPIC_MPU_XPU_PRT6_MCR_ADDR A:0x79b1554
y.create.l HWIO_QPIC_QPIC_MPU_XPU_PRT7_MCR_ADDR A:0x79b15d4
y.create.l HWIO_QPIC_QPIC_MPU_XPU_PRT0_CNTL0_ADDR A:0x79b1258
y.create.l HWIO_QPIC_QPIC_MPU_XPU_PRT1_CNTL0_ADDR A:0x79b12d8
y.create.l HWIO_QPIC_QPIC_MPU_XPU_PRT2_CNTL0_ADDR A:0x79b1358
y.create.l HWIO_QPIC_QPIC_MPU_XPU_PRT3_CNTL0_ADDR A:0x79b13d8
y.create.l HWIO_QPIC_QPIC_MPU_XPU_PRT4_CNTL0_ADDR A:0x79b1458
y.create.l HWIO_QPIC_QPIC_MPU_XPU_PRT5_CNTL0_ADDR A:0x79b14d8
y.create.l HWIO_QPIC_QPIC_MPU_XPU_PRT6_CNTL0_ADDR A:0x79b1558
y.create.l HWIO_QPIC_QPIC_MPU_XPU_PRT7_CNTL0_ADDR A:0x79b15d8
y.create.l HWIO_QPIC_QPIC_MPU_XPU_PRT0_CNTL1_ADDR A:0x79b125c
y.create.l HWIO_QPIC_QPIC_MPU_XPU_PRT1_CNTL1_ADDR A:0x79b12dc
y.create.l HWIO_QPIC_QPIC_MPU_XPU_PRT2_CNTL1_ADDR A:0x79b135c
y.create.l HWIO_QPIC_QPIC_MPU_XPU_PRT3_CNTL1_ADDR A:0x79b13dc
y.create.l HWIO_QPIC_QPIC_MPU_XPU_PRT4_CNTL1_ADDR A:0x79b145c
y.create.l HWIO_QPIC_QPIC_MPU_XPU_PRT5_CNTL1_ADDR A:0x79b14dc
y.create.l HWIO_QPIC_QPIC_MPU_XPU_PRT6_CNTL1_ADDR A:0x79b155c
y.create.l HWIO_QPIC_QPIC_MPU_XPU_PRT7_CNTL1_ADDR A:0x79b15dc
y.create.l HWIO_RBCPR_VERSION_ADDR A:0x48000
y.create.l HWIO_RBCPR_SENSOR_MASK0_ADDR A:0x48020
y.create.l HWIO_RBCPR_SENSOR_MASK1_ADDR A:0x48024
y.create.l HWIO_RBCPR_SENSOR_MASK2_ADDR A:0x48028
y.create.l HWIO_RBCPR_SENSOR_MASK3_ADDR A:0x4802c
y.create.l HWIO_RBCPR_SENSOR_BYPASS0_ADDR A:0x48030
y.create.l HWIO_RBCPR_SENSOR_BYPASS1_ADDR A:0x48034
y.create.l HWIO_RBCPR_SENSOR_BYPASS2_ADDR A:0x48038
y.create.l HWIO_RBCPR_SENSOR_BYPASS3_ADDR A:0x4803c
y.create.l HWIO_RBIF_PMIC_ADDR_ADDR A:0x48040
y.create.l HWIO_RBCPR_TIMER_INTERVAL_ADDR A:0x48044
y.create.l HWIO_RBIF_LIMIT_ADDR A:0x48048
y.create.l HWIO_RBIF_TIMER_ADJUST_ADDR A:0x4804c
y.create.l HWIO_RBCPR_GCNT_TARGET0_ADDR A:0x48060
y.create.l HWIO_RBCPR_GCNT_TARGET1_ADDR A:0x48064
y.create.l HWIO_RBCPR_GCNT_TARGET2_ADDR A:0x48068
y.create.l HWIO_RBCPR_GCNT_TARGET3_ADDR A:0x4806c
y.create.l HWIO_RBCPR_GCNT_TARGET4_ADDR A:0x48070
y.create.l HWIO_RBCPR_GCNT_TARGET5_ADDR A:0x48074
y.create.l HWIO_RBCPR_GCNT_TARGET6_ADDR A:0x48078
y.create.l HWIO_RBCPR_GCNT_TARGET7_ADDR A:0x4807c
y.create.l HWIO_RBCPR_STEP_QUOT_ADDR A:0x48080
y.create.l HWIO_RBCPR_CTL_ADDR A:0x48090
y.create.l HWIO_RBIF_SW_VLEVEL_ADDR A:0x48094
y.create.l HWIO_RBIF_CONT_ACK_CMD_ADDR A:0x48098
y.create.l HWIO_RBIF_CONT_NACK_CMD_ADDR A:0x4809c
y.create.l HWIO_RBCPR_RESULT_0_ADDR A:0x480a0
y.create.l HWIO_RBCPR_RESULT_1_ADDR A:0x480a4
y.create.l HWIO_RBIF_IRQ_EN_0_ADDR A:0x48100
y.create.l HWIO_RBIF_IRQ_EN_1_ADDR A:0x48104
y.create.l HWIO_RBIF_IRQ_EN_2_ADDR A:0x48108
y.create.l HWIO_RBIF_IRQ_CLEAR_ADDR A:0x48110
y.create.l HWIO_RBIF_IRQ_STATUS_ADDR A:0x48114
y.create.l HWIO_RBCPR_QUOT_AVG_ADDR A:0x48118
y.create.l HWIO_RBCPR_DEBUG0_ADDR A:0x4811c
y.create.l HWIO_RBCPR_DEBUG1_ADDR A:0x48120
y.create.l HWIO_RBCPR_DEBUG2_ADDR A:0x48124
y.create.l HWIO_RBCPR_BIST_MINMAX_ADDR A:0x48128
y.create.l HWIO_RBCPR_BIST_RESULT_ADDR A:0x4812c
y.create.l HWIO_RBCPR_BIST_FAIL_MAP0_ADDR A:0x48130
y.create.l HWIO_RBCPR_BIST_FAIL_MAP1_ADDR A:0x48134
y.create.l HWIO_RBCPR_BIST_FAIL_MAP2_ADDR A:0x48138
y.create.l HWIO_RBCPR_BIST_FAIL_MAP3_ADDR A:0x4813c
y.create.l HWIO_RBCPR_LOG_0_ADDR A:0x48140
y.create.l HWIO_RBCPR_LOG_1_ADDR A:0x48144
y.create.l HWIO_RBCPR_LOG_2_ADDR A:0x48148
y.create.l HWIO_RBCPR_LOG_3_ADDR A:0x4814c
y.create.l HWIO_RBCPR_LOG_4_ADDR A:0x48150
y.create.l HWIO_RBCPR_LOG_5_ADDR A:0x48154
y.create.l HWIO_RBCPR_LOG_6_ADDR A:0x48158
y.create.l HWIO_RBCPR_LOG_7_ADDR A:0x4815c
y.create.l HWIO_RBCPR_HTOL_AGE_ADDR A:0x48160
y.create.l HWIO_RPM_HW_VERSION_ADDR A:0x280000
y.create.l HWIO_RPM_WFI_CONFIG_ADDR A:0x280004
y.create.l HWIO_RPM_TIMERS_CLK_OFF_CTL_ADDR A:0x280008
y.create.l HWIO_RPM_IPC_ADDR A:0x28000c
y.create.l HWIO_RPM_GPO_WDATA_ADDR A:0x280010
y.create.l HWIO_RPM_GPO_WDSET_ADDR A:0x280014
y.create.l HWIO_RPM_GPO_WDCLR_ADDR A:0x280018
y.create.l HWIO_RPM_SLAVES_CLK_GATING_ADDR A:0x28001c
y.create.l HWIO_RPM_INTR_POLARITY_0_ADDR A:0x280030
y.create.l HWIO_RPM_INTR_POLARITY_1_ADDR A:0x280034
y.create.l HWIO_RPM_INTR_EDG_LVL_0_ADDR A:0x280038
y.create.l HWIO_RPM_INTR_EDG_LVL_1_ADDR A:0x28003c
y.create.l HWIO_RPM_WDOG_RESET_ADDR A:0x280040
y.create.l HWIO_RPM_WDOG_CTRL_ADDR A:0x280044
y.create.l HWIO_RPM_WDOG_STATUS_ADDR A:0x280048
y.create.l HWIO_RPM_WDOG_BARK_TIME_ADDR A:0x28004c
y.create.l HWIO_RPM_WDOG_BITE_TIME_ADDR A:0x280050
y.create.l HWIO_RPM_WDOG_TEST_LOAD_ADDR A:0x280054
y.create.l HWIO_RPM_WDOG_TEST_ADDR A:0x280058
y.create.l HWIO_RPM_TEST_BUS_SEL_ADDR A:0x28005c
y.create.l HWIO_RPM_SPARE_REG0_ADDR A:0x280060
y.create.l HWIO_RPM_SPARE_REG1_ADDR A:0x280064
y.create.l HWIO_RPM_SPARE_REG2_ADDR A:0x280068
y.create.l HWIO_RPM_SPARE_REG3_ADDR A:0x28006c
y.create.l HWIO_RPM_PAGE_SELECT_ADDR A:0x280070
y.create.l HWIO_RPM_QTMR_AC_CNTFRQ_ADDR A:0x282000
y.create.l HWIO_RPM_QTMR_AC_CNTSR_ADDR A:0x282004
y.create.l HWIO_RPM_QTMR_AC_CNTTID_ADDR A:0x282008
y.create.l HWIO_RPM_QTMR_AC_CNTACR_0_ADDR A:0x282040
y.create.l HWIO_RPM_QTMR_AC_CNTACR_1_ADDR A:0x282044
y.create.l HWIO_RPM_QTMR_AC_CNTVOFF_LO_0_ADDR A:0x282080
y.create.l HWIO_RPM_QTMR_AC_CNTVOFF_LO_1_ADDR A:0x282088
y.create.l HWIO_RPM_QTMR_AC_CNTVOFF_HI_0_ADDR A:0x282084
y.create.l HWIO_RPM_QTMR_AC_CNTVOFF_HI_1_ADDR A:0x28208c
y.create.l HWIO_RPM_QTMR_AC_CFG_ADDR A:0x282fc0
y.create.l HWIO_RPM_QTMR_AC_VERSION_ADDR A:0x282fd0
y.create.l HWIO_RPM_F0_QTMR_V1_CNTPCT_LO_ADDR A:0x283000
y.create.l HWIO_RPM_F0_QTMR_V1_CNTPCT_HI_ADDR A:0x283004
y.create.l HWIO_RPM_F0_QTMR_V1_CNTVCT_LO_ADDR A:0x283008
y.create.l HWIO_RPM_F0_QTMR_V1_CNTVCT_HI_ADDR A:0x28300c
y.create.l HWIO_RPM_F0_QTMR_V1_CNTFRQ_ADDR A:0x283010
y.create.l HWIO_RPM_F0_QTMR_V1_CNTPL0ACR_ADDR A:0x283014
y.create.l HWIO_RPM_F0_QTMR_V1_CNTVOFF_LO_ADDR A:0x283018
y.create.l HWIO_RPM_F0_QTMR_V1_CNTVOFF_HI_ADDR A:0x28301c
y.create.l HWIO_RPM_F0_QTMR_V1_CNTP_CVAL_LO_ADDR A:0x283020
y.create.l HWIO_RPM_F0_QTMR_V1_CNTP_CVAL_HI_ADDR A:0x283024
y.create.l HWIO_RPM_F0_QTMR_V1_CNTP_TVAL_ADDR A:0x283028
y.create.l HWIO_RPM_F0_QTMR_V1_CNTP_CTL_ADDR A:0x28302c
y.create.l HWIO_RPM_F0_QTMR_V1_CNTV_CVAL_LO_ADDR A:0x283030
y.create.l HWIO_RPM_F0_QTMR_V1_CNTV_CVAL_HI_ADDR A:0x283034
y.create.l HWIO_RPM_F0_QTMR_V1_CNTV_TVAL_ADDR A:0x283038
y.create.l HWIO_RPM_F0_QTMR_V1_CNTV_CTL_ADDR A:0x28303c
y.create.l HWIO_RPM_F0_QTMR_V1_VERSION_ADDR A:0x283fd0
y.create.l HWIO_RPM_F1_QTMR_V1_CNTPCT_LO_ADDR A:0x284000
y.create.l HWIO_RPM_F1_QTMR_V1_CNTPCT_HI_ADDR A:0x284004
y.create.l HWIO_RPM_F1_QTMR_V1_CNTVCT_LO_ADDR A:0x284008
y.create.l HWIO_RPM_F1_QTMR_V1_CNTVCT_HI_ADDR A:0x28400c
y.create.l HWIO_RPM_F1_QTMR_V1_CNTFRQ_ADDR A:0x284010
y.create.l HWIO_RPM_F1_QTMR_V1_CNTPL0ACR_ADDR A:0x284014
y.create.l HWIO_RPM_F1_QTMR_V1_CNTVOFF_LO_ADDR A:0x284018
y.create.l HWIO_RPM_F1_QTMR_V1_CNTVOFF_HI_ADDR A:0x28401c
y.create.l HWIO_RPM_F1_QTMR_V1_CNTP_CVAL_LO_ADDR A:0x284020
y.create.l HWIO_RPM_F1_QTMR_V1_CNTP_CVAL_HI_ADDR A:0x284024
y.create.l HWIO_RPM_F1_QTMR_V1_CNTP_TVAL_ADDR A:0x284028
y.create.l HWIO_RPM_F1_QTMR_V1_CNTP_CTL_ADDR A:0x28402c
y.create.l HWIO_RPM_F1_QTMR_V1_CNTV_CVAL_LO_ADDR A:0x284030
y.create.l HWIO_RPM_F1_QTMR_V1_CNTV_CVAL_HI_ADDR A:0x284034
y.create.l HWIO_RPM_F1_QTMR_V1_CNTV_TVAL_ADDR A:0x284038
y.create.l HWIO_RPM_F1_QTMR_V1_CNTV_CTL_ADDR A:0x28403c
y.create.l HWIO_RPM_F1_QTMR_V1_VERSION_ADDR A:0x284fd0
y.create.l HWIO_RPM_APU_XPU_SCR_ADDR A:0x287000
y.create.l HWIO_RPM_APU_XPU_SWDR_ADDR A:0x287004
y.create.l HWIO_RPM_APU_XPU_SEAR0_ADDR A:0x287040
y.create.l HWIO_RPM_APU_XPU_SESR_ADDR A:0x287048
y.create.l HWIO_RPM_APU_XPU_SESRRESTORE_ADDR A:0x28704c
y.create.l HWIO_RPM_APU_XPU_SESYNR0_ADDR A:0x287050
y.create.l HWIO_RPM_APU_XPU_SESYNR1_ADDR A:0x287054
y.create.l HWIO_RPM_APU_XPU_SESYNR2_ADDR A:0x287058
y.create.l HWIO_RPM_APU_XPU_MCR_ADDR A:0x287100
y.create.l HWIO_RPM_APU_XPU_MEAR0_ADDR A:0x287140
y.create.l HWIO_RPM_APU_XPU_MESR_ADDR A:0x287148
y.create.l HWIO_RPM_APU_XPU_MESRRESTORE_ADDR A:0x28714c
y.create.l HWIO_RPM_APU_XPU_MESYNR0_ADDR A:0x287150
y.create.l HWIO_RPM_APU_XPU_MESYNR1_ADDR A:0x287154
y.create.l HWIO_RPM_APU_XPU_MESYNR2_ADDR A:0x287158
y.create.l HWIO_RPM_APU_XPU_CR_ADDR A:0x287080
y.create.l HWIO_RPM_APU_XPU_RPU_ACR0_ADDR A:0x2870a0
y.create.l HWIO_RPM_APU_XPU_EAR0_ADDR A:0x2870c0
y.create.l HWIO_RPM_APU_XPU_ESR_ADDR A:0x2870c8
y.create.l HWIO_RPM_APU_XPU_ESRRESTORE_ADDR A:0x2870cc
y.create.l HWIO_RPM_APU_XPU_ESYNR0_ADDR A:0x2870d0
y.create.l HWIO_RPM_APU_XPU_ESYNR1_ADDR A:0x2870d4
y.create.l HWIO_RPM_APU_XPU_ESYNR2_ADDR A:0x2870d8
y.create.l HWIO_RPM_APU_XPU_IDR0_ADDR A:0x287074
y.create.l HWIO_RPM_APU_XPU_IDR1_ADDR A:0x287078
y.create.l HWIO_RPM_APU_XPU_REV_ADDR A:0x28707c
y.create.l HWIO_RPM_APU_XPU_RG0_RACR0_ADDR A:0x287200
y.create.l HWIO_RPM_APU_XPU_RG1_RACR0_ADDR A:0x287280
y.create.l HWIO_RPM_APU_XPU_RG0_WACR0_ADDR A:0x287220
y.create.l HWIO_RPM_APU_XPU_RG1_WACR0_ADDR A:0x2872a0
y.create.l HWIO_RPM_APU_XPU_RG0_SCR_ADDR A:0x287250
y.create.l HWIO_RPM_APU_XPU_RG1_SCR_ADDR A:0x2872d0
y.create.l HWIO_RPM_APU_XPU_RG0_MCR_ADDR A:0x287254
y.create.l HWIO_RPM_APU_XPU_RG1_MCR_ADDR A:0x2872d4
y.create.l HWIO_RPM_VMIDMT_SCR0_ADDR A:0x288000
y.create.l HWIO_RPM_VMIDMT_SCR1_ADDR A:0x288004
y.create.l HWIO_RPM_VMIDMT_SCR2_ADDR A:0x288008
y.create.l HWIO_RPM_VMIDMT_SACR_ADDR A:0x288010
y.create.l HWIO_RPM_VMIDMT_SIDR0_ADDR A:0x288020
y.create.l HWIO_RPM_VMIDMT_SIDR1_ADDR A:0x288024
y.create.l HWIO_RPM_VMIDMT_SIDR2_ADDR A:0x288028
y.create.l HWIO_RPM_VMIDMT_SIDR4_ADDR A:0x288030
y.create.l HWIO_RPM_VMIDMT_SIDR5_ADDR A:0x288034
y.create.l HWIO_RPM_VMIDMT_SIDR7_ADDR A:0x28803c
y.create.l HWIO_RPM_VMIDMT_SGFAR0_ADDR A:0x288040
y.create.l HWIO_RPM_VMIDMT_SGFSR_ADDR A:0x288048
y.create.l HWIO_RPM_VMIDMT_SGFSRRESTORE_ADDR A:0x28804c
y.create.l HWIO_RPM_VMIDMT_SGFSYNDR0_ADDR A:0x288050
y.create.l HWIO_RPM_VMIDMT_SGFSYNDR1_ADDR A:0x288054
y.create.l HWIO_RPM_VMIDMT_SGFSYNDR2_ADDR A:0x288058
y.create.l HWIO_RPM_VMIDMT_VMIDMTSCR0_ADDR A:0x288090
y.create.l HWIO_RPM_VMIDMT_CR0_ADDR A:0x288000
y.create.l HWIO_RPM_VMIDMT_CR2_ADDR A:0x288008
y.create.l HWIO_RPM_VMIDMT_ACR_ADDR A:0x288010
y.create.l HWIO_RPM_VMIDMT_IDR0_ADDR A:0x288020
y.create.l HWIO_RPM_VMIDMT_IDR1_ADDR A:0x288024
y.create.l HWIO_RPM_VMIDMT_IDR2_ADDR A:0x288028
y.create.l HWIO_RPM_VMIDMT_IDR4_ADDR A:0x288030
y.create.l HWIO_RPM_VMIDMT_IDR5_ADDR A:0x288034
y.create.l HWIO_RPM_VMIDMT_IDR7_ADDR A:0x28803c
y.create.l HWIO_RPM_VMIDMT_GFAR0_ADDR A:0x288040
y.create.l HWIO_RPM_VMIDMT_GFSR_ADDR A:0x288048
y.create.l HWIO_RPM_VMIDMT_GFSRRESTORE_ADDR A:0x28804c
y.create.l HWIO_RPM_VMIDMT_GFSYNDR0_ADDR A:0x288050
y.create.l HWIO_RPM_VMIDMT_GFSYNDR1_ADDR A:0x288054
y.create.l HWIO_RPM_VMIDMT_GFSYNDR2_ADDR A:0x288058
y.create.l HWIO_RPM_VMIDMT_VMIDMTCR0_ADDR A:0x288090
y.create.l HWIO_RPM_VMIDMT_VMIDMTACR_ADDR A:0x28809c
y.create.l HWIO_RPM_VMIDMT_NSCR0_ADDR A:0x288400
y.create.l HWIO_RPM_VMIDMT_NSCR2_ADDR A:0x288408
y.create.l HWIO_RPM_VMIDMT_NSACR_ADDR A:0x288410
y.create.l HWIO_RPM_VMIDMT_NSGFAR0_ADDR A:0x288440
y.create.l HWIO_RPM_VMIDMT_NSGFSR_ADDR A:0x288448
y.create.l HWIO_RPM_VMIDMT_NSGFSRRESTORE_ADDR A:0x28844c
y.create.l HWIO_RPM_VMIDMT_NSGFSYNDR0_ADDR A:0x288450
y.create.l HWIO_RPM_VMIDMT_NSGFSYNDR1_ADDR A:0x288454
y.create.l HWIO_RPM_VMIDMT_NSGFSYNDR2_ADDR A:0x288458
y.create.l HWIO_RPM_VMIDMT_NSVMIDMTCR0_ADDR A:0x288490
y.create.l HWIO_RPM_VMIDMT_SSDR0_ADDR A:0x288080
y.create.l HWIO_RPM_VMIDMT_MSDR0_ADDR A:0x288480
y.create.l HWIO_RPM_VMIDMT_MCR_ADDR A:0x288494
y.create.l HWIO_RPM_VMIDMT_S2VR0_ADDR A:0x288c00
y.create.l HWIO_RPM_VMIDMT_AS2VR0_ADDR A:0x288e00
y.create.l HWIO_SDC1_SDCC_MCI_POWER_ADDR A:0x7824000
y.create.l HWIO_SDC1_SDCC_MCI_CLK_ADDR A:0x7824004
y.create.l HWIO_SDC1_SDCC_MCI_ARGUMENT_ADDR A:0x7824008
y.create.l HWIO_SDC1_SDCC_MCI_CMD_ADDR A:0x782400c
y.create.l HWIO_SDC1_SDCC_MCI_RESP_CMD_ADDR A:0x7824010
y.create.l HWIO_SDC1_SDCC_MCI_RESP0_ADDR A:0x7824014
y.create.l HWIO_SDC1_SDCC_MCI_RESP1_ADDR A:0x7824018
y.create.l HWIO_SDC1_SDCC_MCI_RESP2_ADDR A:0x782401c
y.create.l HWIO_SDC1_SDCC_MCI_RESP3_ADDR A:0x7824020
y.create.l HWIO_SDC1_SDCC_MCI_DATA_TIMER_ADDR A:0x7824024
y.create.l HWIO_SDC1_SDCC_MCI_DATA_LENGTH_ADDR A:0x7824028
y.create.l HWIO_SDC1_SDCC_MCI_DATA_CTL_ADDR A:0x782402c
y.create.l HWIO_SDC1_SDCC_MCI_DATA_COUNT_ADDR A:0x7824030
y.create.l HWIO_SDC1_SDCC_MCI_STATUS_ADDR A:0x7824034
y.create.l HWIO_SDC1_SDCC_MCI_CLEAR_ADDR A:0x7824038
y.create.l HWIO_SDC1_SDCC_MCI_INT_MASK0_ADDR A:0x782403c
y.create.l HWIO_SDC1_SDCC_MCI_INT_MASK1_ADDR A:0x7824040
y.create.l HWIO_SDC1_SDCC_MCI_FIFO_COUNT_ADDR A:0x7824044
y.create.l HWIO_SDC1_SDCC_MCI_BOOT_ADDR A:0x7824048
y.create.l HWIO_SDC1_SDCC_MCI_BOOT_ACK_TIMER_ADDR A:0x782404c
y.create.l HWIO_SDC1_SDCC_MCI_VERSION_ADDR A:0x7824050
y.create.l HWIO_SDC1_SDCC_MCI_EMULATION_DLY_LINE_ADDR A:0x7824054
y.create.l HWIO_SDC1_SDCC_MCI_CCS_TIMER_ADDR A:0x7824058
y.create.l HWIO_SDC1_SDCC_MCI_RESPONSE_MASK_ADDR A:0x782405c
y.create.l HWIO_SDC1_SDCC_MCI_DLL_CONFIG_ADDR A:0x7824060
y.create.l HWIO_SDC1_SDCC_MCI_DLL_TEST_CTL_ADDR A:0x7824064
y.create.l HWIO_SDC1_SDCC_MCI_DLL_STATUS_ADDR A:0x7824068
y.create.l HWIO_SDC1_SDCC_MCI_STATUS2_ADDR A:0x782406c
y.create.l HWIO_SDC1_SDCC_MCI_GENERICS_ADDR A:0x7824070
y.create.l HWIO_SDC1_SDCC_MCI_FIFO_STATUS_ADDR A:0x7824074
y.create.l HWIO_SDC1_SDCC_MCI_HC_MODE_ADDR A:0x7824078
y.create.l HWIO_SDC1_SDCC_MCI_FIFO0_ADDR A:0x7824080
y.create.l HWIO_SDC1_SDCC_MCI_FIFO1_ADDR A:0x7824084
y.create.l HWIO_SDC1_SDCC_MCI_FIFO2_ADDR A:0x7824088
y.create.l HWIO_SDC1_SDCC_MCI_FIFO3_ADDR A:0x782408c
y.create.l HWIO_SDC1_SDCC_MCI_FIFO4_ADDR A:0x7824090
y.create.l HWIO_SDC1_SDCC_MCI_FIFO5_ADDR A:0x7824094
y.create.l HWIO_SDC1_SDCC_MCI_FIFO6_ADDR A:0x7824098
y.create.l HWIO_SDC1_SDCC_MCI_FIFO7_ADDR A:0x782409c
y.create.l HWIO_SDC1_SDCC_MCI_FIFO8_ADDR A:0x78240a0
y.create.l HWIO_SDC1_SDCC_MCI_FIFO9_ADDR A:0x78240a4
y.create.l HWIO_SDC1_SDCC_MCI_TESTBUS_CONFIG_ADDR A:0x78240cc
y.create.l HWIO_SDC1_SDCC_MCI_TEST_CTL_ADDR A:0x78240d0
y.create.l HWIO_SDC1_SDCC_MCI_TEST_INPUT_ADDR A:0x78240d4
y.create.l HWIO_SDC1_SDCC_MCI_TEST_OUT_ADDR A:0x78240d8
y.create.l HWIO_SDC1_SDCC_MCI_PWRCTL_STATUS_REG_ADDR A:0x78240dc
y.create.l HWIO_SDC1_SDCC_MCI_PWRCTL_MASK_REG_ADDR A:0x78240e0
y.create.l HWIO_SDC1_SDCC_MCI_PWRCTL_CLEAR_REG_ADDR A:0x78240e4
y.create.l HWIO_SDC1_SDCC_MCI_PWRCTL_CTL_REG_ADDR A:0x78240e8
y.create.l HWIO_SDC1_SDCC_MCI_CLEAR2_ADDR A:0x78240ec
y.create.l HWIO_SDC1_SDCC_MCI_INT_MASKINT2_0_ADDR A:0x78240f0
y.create.l HWIO_SDC1_SDCC_MCI_INT_MASKINT2_1_ADDR A:0x78240f4
y.create.l HWIO_SDC1_SDCC_CHAR_CFG_ADDR A:0x78240fc
y.create.l HWIO_SDC1_SDCC_CHAR_CMD_ADDR A:0x7824100
y.create.l HWIO_SDC1_SDCC_CHAR_DATA_0_ADDR A:0x7824104
y.create.l HWIO_SDC1_SDCC_CHAR_DATA_1_ADDR A:0x7824108
y.create.l HWIO_SDC1_SDCC_CHAR_DATA_2_ADDR A:0x782410c
y.create.l HWIO_SDC1_SDCC_CHAR_DATA_3_ADDR A:0x7824110
y.create.l HWIO_SDC1_SDCC_CHAR_DATA_4_ADDR A:0x7824114
y.create.l HWIO_SDC1_SDCC_CHAR_DATA_5_ADDR A:0x7824118
y.create.l HWIO_SDC1_SDCC_CHAR_DATA_6_ADDR A:0x782411c
y.create.l HWIO_SDC1_SDCC_CHAR_DATA_7_ADDR A:0x7824120
y.create.l HWIO_SDC1_SDCC_DEBUG_REG_ADDR A:0x7824124
y.create.l HWIO_SDC1_SDCC_IP_CATALOG_ADDR A:0x7824128
y.create.l HWIO_SDC1_SDCC_QSB_VALUES_ADDR A:0x782412c
y.create.l HWIO_SDC1_SDCC_QSB_AXI_VALUES_ADDR A:0x7824130
y.create.l HWIO_SDC1_SDCC_AXI_DATA_ERR_DBUG_ADDR A:0x7824134
y.create.l HWIO_SDC1_SDCC_T4_DLY_CTRL_ADDR A:0x7824138
y.create.l HWIO_SDC1_SDCC_T4_DLY_STAT_ADDR A:0x782413c
y.create.l HWIO_SDC1_SDCC_CSR_CDC_CTLR_CFG0_ADDR A:0x7824140
y.create.l HWIO_SDC1_SDCC_CSR_CDC_CTLR_CFG1_ADDR A:0x7824144
y.create.l HWIO_SDC1_SDCC_CSR_CDC_CAL_TIMER_CFG0_ADDR A:0x7824148
y.create.l HWIO_SDC1_SDCC_CSR_CDC_CAL_TIMER_CFG1_ADDR A:0x782414c
y.create.l HWIO_SDC1_SDCC_CSR_CDC_REFCOUNT_CFG_ADDR A:0x7824150
y.create.l HWIO_SDC1_SDCC_CSR_CDC_COARSE_CAL_CFG_ADDR A:0x7824154
y.create.l HWIO_SDC1_SDCC_CSR_CDC_RSVD_CFG_ADDR A:0x7824158
y.create.l HWIO_SDC1_SDCC_CSR_CDC_OFFSET_CFG_ADDR A:0x782415c
y.create.l HWIO_SDC1_SDCC_CSR_CDC_DELAY_CFG_ADDR A:0x7824160
y.create.l HWIO_SDC1_SDCC_CSR_CDC_SW_MODE_CFG_ADDR A:0x7824164
y.create.l HWIO_SDC1_SDCC_CSR_CDC_TEST_CFG_ADDR A:0x7824168
y.create.l HWIO_SDC1_SDCC_CSR_CDC_SW_OVRD_CFG_ADDR A:0x782416c
y.create.l HWIO_SDC1_SDCC_CSR_CDC_SLAVE_DDA_CFG_ADDR A:0x7824170
y.create.l HWIO_SDC1_SDCC_CSR_CDC_STATUS0_ADDR A:0x7824174
y.create.l HWIO_SDC1_SDCC_CSR_CDC_STATUS1_ADDR A:0x7824178
y.create.l HWIO_SDC1_SDCC_CSR_CDC_STATUS2_ADDR A:0x782417c
y.create.l HWIO_SDC1_SDCC_CSR_CDC_STATUS3_ADDR A:0x7824180
y.create.l HWIO_SDC1_SDCC_CSR_CDC_STATUS4_ADDR A:0x7824184
y.create.l HWIO_SDC1_SDCC_CSR_CDC_GEN_CFG_ADDR A:0x7824188
y.create.l HWIO_SDC1_SDCC_CDC_AUTO_SW_CAL_CFG_ADDR A:0x782418c
y.create.l HWIO_SDC1_SDCC_DDR200_STAT_ADDR A:0x7824190
y.create.l HWIO_SDC1_SDCC_DDR200_CFG_ADDR A:0x7824194
y.create.l HWIO_SDC1_SDCC_TIME_COUNT_CTRL_ADDR A:0x7824198
y.create.l HWIO_SDC1_SDCC_FLOW_CTRL_TIME_COUNT_ADDR A:0x782419c
y.create.l HWIO_SDC1_SDCC_BUSY_TIME_COUNT_ADDR A:0x78241a0
y.create.l HWIO_SDC1_SDCC_DATA_TIME_COUNT_ADDR A:0x78241a4
y.create.l HWIO_SDC1_SDCC_CMD_TIME_COUNT_ADDR A:0x78241a8
y.create.l HWIO_SDC1_SDCC_MCI_DLL_CONFIG_2_ADDR A:0x78241ac
y.create.l HWIO_SDC1_SDCC_MCI_DDR_CONFIG_ADDR A:0x78241b0
y.create.l HWIO_SDC1_SDCC_MCI_FIFO_ALT0_ADDR A:0x7824400
y.create.l HWIO_SDC1_SDCC_MCI_FIFO_ALT1_ADDR A:0x7824404
y.create.l HWIO_SDC1_SDCC_MCI_FIFO_ALT2_ADDR A:0x7824408
y.create.l HWIO_SDC1_SDCC_MCI_FIFO_ALT3_ADDR A:0x782440c
y.create.l HWIO_SDC1_SDCC_MCI_FIFO_ALT4_ADDR A:0x7824410
y.create.l HWIO_SDC1_SDCC_MCI_FIFO_ALT5_ADDR A:0x7824414
y.create.l HWIO_SDC1_SDCC_MCI_FIFO_ALT6_ADDR A:0x7824418
y.create.l HWIO_SDC1_SDCC_MCI_FIFO_ALT7_ADDR A:0x782441c
y.create.l HWIO_SDC1_SDCC_MCI_FIFO_ALT8_ADDR A:0x7824420
y.create.l HWIO_SDC1_SDCC_MCI_FIFO_ALT9_ADDR A:0x7824424
y.create.l HWIO_SDC1_SDCC_HC_REG_0_2_ADDR A:0x7824900
y.create.l HWIO_SDC1_SDCC_HC_REG_4_6_ADDR A:0x7824904
y.create.l HWIO_SDC1_SDCC_HC_REG_8_A_ADDR A:0x7824908
y.create.l HWIO_SDC1_SDCC_HC_REG_C_E_ADDR A:0x782490c
y.create.l HWIO_SDC1_SDCC_HC_REG_10_12_ADDR A:0x7824910
y.create.l HWIO_SDC1_SDCC_HC_REG_14_16_ADDR A:0x7824914
y.create.l HWIO_SDC1_SDCC_HC_REG_18_1A_ADDR A:0x7824918
y.create.l HWIO_SDC1_SDCC_HC_REG_1C_1E_ADDR A:0x782491c
y.create.l HWIO_SDC1_SDCC_HC_REG_20_22_ADDR A:0x7824920
y.create.l HWIO_SDC1_SDCC_HC_REG_24_26_ADDR A:0x7824924
y.create.l HWIO_SDC1_SDCC_HC_REG_28_2A_ADDR A:0x7824928
y.create.l HWIO_SDC1_SDCC_HC_REG_2C_2E_ADDR A:0x782492c
y.create.l HWIO_SDC1_SDCC_HC_REG_30_32_ADDR A:0x7824930
y.create.l HWIO_SDC1_SDCC_HC_REG_34_36_ADDR A:0x7824934
y.create.l HWIO_SDC1_SDCC_HC_REG_38_3A_ADDR A:0x7824938
y.create.l HWIO_SDC1_SDCC_HC_REG_3C_3E_ADDR A:0x782493c
y.create.l HWIO_SDC1_SDCC_HC_REG_40_42_ADDR A:0x7824940
y.create.l HWIO_SDC1_SDCC_HC_REG_44_46_ADDR A:0x7824944
y.create.l HWIO_SDC1_SDCC_HC_REG_48_4A_ADDR A:0x7824948
y.create.l HWIO_SDC1_SDCC_HC_REG_50_52_ADDR A:0x7824950
y.create.l HWIO_SDC1_SDCC_HC_REG_54_56_ADDR A:0x7824954
y.create.l HWIO_SDC1_SDCC_HC_REG_58_5A_ADDR A:0x7824958
y.create.l HWIO_SDC1_SDCC_HC_REG_5C_5E_ADDR A:0x782495c
y.create.l HWIO_SDC1_SDCC_HC_REG_60_62_ADDR A:0x7824960
y.create.l HWIO_SDC1_SDCC_HC_REG_64_66_ADDR A:0x7824964
y.create.l HWIO_SDC1_SDCC_HC_REG_68_6A_ADDR A:0x7824968
y.create.l HWIO_SDC1_SDCC_HC_REG_6C_6E_ADDR A:0x782496c
y.create.l HWIO_SDC1_SDCC_HC_REG_E0_E2_ADDR A:0x78249e0
y.create.l HWIO_SDC1_SDCC_HC_REG_FC_FE_ADDR A:0x78249fc
y.create.l HWIO_SDC1_SDCC_HC_REG_DLL_CONFIG_ADDR A:0x7824a00
y.create.l HWIO_SDC1_SDCC_HC_REG_DLL_TEST_CTL_ADDR A:0x7824a04
y.create.l HWIO_SDC1_SDCC_HC_REG_DLL_STATUS_ADDR A:0x7824a08
y.create.l HWIO_SDC1_SDCC_HC_VENDOR_SPECIFIC_FUNC_ADDR A:0x7824a0c
y.create.l HWIO_SDC1_SDCC_HC_VENDOR_SPECIFIC_FUNC2_ADDR A:0x7824a10
y.create.l HWIO_SDC1_SDCC_HC_VENDOR_SPECIFIC_ADMA_ERR_ADDR0_ADDR A:0x7824a14
y.create.l HWIO_SDC1_SDCC_HC_VENDOR_SPECIFIC_ADMA_ERR_ADDR1_ADDR A:0x7824a18
y.create.l HWIO_SDC1_SDCC_HC_VENDOR_SPECIFIC_CAPABILITIES0_ADDR A:0x7824a1c
y.create.l HWIO_SDC1_SDCC_HC_VENDOR_SPECIFIC_CAPABILITIES1_ADDR A:0x7824a20
y.create.l HWIO_SDC1_SDCC_HC_VENDOR_SPECIFIC_T4_DLY_CTRL_ADDR A:0x7824a24
y.create.l HWIO_SDC1_SDCC_HC_VENDOR_SPECIFIC_T4_DLY_STAT_ADDR A:0x7824a28
y.create.l HWIO_SDC1_SDCC_HC_VENDOR_SPECIFIC_CSR_CDC_CTLR_CFG0_ADDR A:0x7824a30
y.create.l HWIO_SDC1_SDCC_HC_VENDOR_SPECIFIC_CSR_CDC_CTLR_CFG1_ADDR A:0x7824a34
y.create.l HWIO_SDC1_SDCC_HC_VENDOR_SPECIFIC_CSR_CDC_CAL_TIMER_CFG0_ADDR A:0x7824a38
y.create.l HWIO_SDC1_SDCC_HC_VENDOR_SPECIFIC_CSR_CDC_CAL_TIMER_CFG1_ADDR A:0x7824a3c
y.create.l HWIO_SDC1_SDCC_HC_VENDOR_SPECIFIC_CSR_CDC_REFCOUNT_CFG_ADDR A:0x7824a40
y.create.l HWIO_SDC1_SDCC_HC_VENDOR_SPECIFIC_CSR_CDC_COARSE_CAL_CFG_ADDR A:0x7824a44
y.create.l HWIO_SDC1_SDCC_HC_VENDOR_SPECIFIC_CSR_CDC_RSVD_CFG_ADDR A:0x7824a48
y.create.l HWIO_SDC1_SDCC_HC_VENDOR_SPECIFIC_CSR_CDC_OFFSET_CFG_ADDR A:0x7824a4c
y.create.l HWIO_SDC1_SDCC_HC_VENDOR_SPECIFIC_CSR_CDC_DELAY_CFG_ADDR A:0x7824a50
y.create.l HWIO_SDC1_SDCC_HC_VENDOR_SPECIFIC_CSR_CDC_SW_MODE_CFG_ADDR A:0x7824a54
y.create.l HWIO_SDC1_SDCC_HC_VENDOR_SPECIFIC_CSR_CDC_TEST_CFG_ADDR A:0x7824a58
y.create.l HWIO_SDC1_SDCC_HC_VENDOR_SPECIFIC_CSR_CDC_SW_OVRD_CFG_ADDR A:0x7824a5c
y.create.l HWIO_SDC1_SDCC_HC_VENDOR_SPECIFIC_CSR_CDC_SLAVE_DDA_CFG_ADDR A:0x7824a60
y.create.l HWIO_SDC1_SDCC_HC_VENDOR_SPECIFIC_CSR_CDC_STATUS0_ADDR A:0x7824a64
y.create.l HWIO_SDC1_SDCC_HC_VENDOR_SPECIFIC_CSR_CDC_STATUS1_ADDR A:0x7824a68
y.create.l HWIO_SDC1_SDCC_HC_VENDOR_SPECIFIC_CSR_CDC_STATUS2_ADDR A:0x7824a6c
y.create.l HWIO_SDC1_SDCC_HC_VENDOR_SPECIFIC_CSR_CDC_STATUS3_ADDR A:0x7824a70
y.create.l HWIO_SDC1_SDCC_HC_VENDOR_SPECIFIC_CSR_CDC_STATUS4_ADDR A:0x7824a74
y.create.l HWIO_SDC1_SDCC_HC_VENDOR_SPECIFIC_CSR_CDC_GEN_CFG_ADDR A:0x7824a78
y.create.l HWIO_SDC1_SDCC_HC_VENDOR_SPECIFIC_CDC_AUTO_SW_CAL_CFG_ADDR A:0x7824a7c
y.create.l HWIO_SDC1_SDCC_HC_VENDOR_SPECIFIC_DDR200_STAT_ADDR A:0x7824a80
y.create.l HWIO_SDC1_SDCC_HC_VENDOR_SPECIFIC_DDR200_CFG_ADDR A:0x7824a84
y.create.l HWIO_SDC1_SDCC_HC_VENDOR_SPECIFIC_TIME_COUNT_CTRL_ADDR A:0x7824a88
y.create.l HWIO_SDC1_SDCC_HC_VENDOR_SPECIFIC_FLOW_CTRL_TIME_COUNT_ADDR A:0x7824a8c
y.create.l HWIO_SDC1_SDCC_HC_VENDOR_SPECIFIC_BUSY_TIME_COUNT_ADDR A:0x7824a90
y.create.l HWIO_SDC1_SDCC_HC_VENDOR_SPECIFIC_DATA_TIME_COUNT_ADDR A:0x7824a94
y.create.l HWIO_SDC1_SDCC_HC_VENDOR_SPECIFIC_CMD_TIME_COUNT_ADDR A:0x7824a98
y.create.l HWIO_SDC1_SDCC_HC_VENDOR_SPECIFIC_ERR_INT_STS_ADDR A:0x7824a9c
y.create.l HWIO_SDC1_SDCC_HC_VENDOR_SPECIFIC_PWRCTL_STATUS_REG_ADDR A:0x7824aa0
y.create.l HWIO_SDC1_SDCC_HC_VENDOR_SPECIFIC_PWRCTL_MASK_REG_ADDR A:0x7824aa4
y.create.l HWIO_SDC1_SDCC_HC_VENDOR_SPECIFIC_PWRCTL_CLEAR_REG_ADDR A:0x7824aa8
y.create.l HWIO_SDC1_SDCC_HC_VENDOR_SPECIFIC_PWRCTL_CTL_REG_ADDR A:0x7824aac
y.create.l HWIO_SDC1_SDCC_HC_VENDOR_SPECIFIC_FUNC3_ADDR A:0x7824ab0
y.create.l HWIO_SDC1_SDCC_HC_REG_DLL_CONFIG_2_ADDR A:0x7824ab4
y.create.l HWIO_SDC1_SDCC_HC_REG_DDR_CONFIG_ADDR A:0x7824ab8
y.create.l HWIO_SDC2_SDCC_MCI_POWER_ADDR A:0x7864000
y.create.l HWIO_SDC2_SDCC_MCI_CLK_ADDR A:0x7864004
y.create.l HWIO_SDC2_SDCC_MCI_ARGUMENT_ADDR A:0x7864008
y.create.l HWIO_SDC2_SDCC_MCI_CMD_ADDR A:0x786400c
y.create.l HWIO_SDC2_SDCC_MCI_RESP_CMD_ADDR A:0x7864010
y.create.l HWIO_SDC2_SDCC_MCI_RESP0_ADDR A:0x7864014
y.create.l HWIO_SDC2_SDCC_MCI_RESP1_ADDR A:0x7864018
y.create.l HWIO_SDC2_SDCC_MCI_RESP2_ADDR A:0x786401c
y.create.l HWIO_SDC2_SDCC_MCI_RESP3_ADDR A:0x7864020
y.create.l HWIO_SDC2_SDCC_MCI_DATA_TIMER_ADDR A:0x7864024
y.create.l HWIO_SDC2_SDCC_MCI_DATA_LENGTH_ADDR A:0x7864028
y.create.l HWIO_SDC2_SDCC_MCI_DATA_CTL_ADDR A:0x786402c
y.create.l HWIO_SDC2_SDCC_MCI_DATA_COUNT_ADDR A:0x7864030
y.create.l HWIO_SDC2_SDCC_MCI_STATUS_ADDR A:0x7864034
y.create.l HWIO_SDC2_SDCC_MCI_CLEAR_ADDR A:0x7864038
y.create.l HWIO_SDC2_SDCC_MCI_INT_MASK0_ADDR A:0x786403c
y.create.l HWIO_SDC2_SDCC_MCI_INT_MASK1_ADDR A:0x7864040
y.create.l HWIO_SDC2_SDCC_MCI_FIFO_COUNT_ADDR A:0x7864044
y.create.l HWIO_SDC2_SDCC_MCI_BOOT_ADDR A:0x7864048
y.create.l HWIO_SDC2_SDCC_MCI_BOOT_ACK_TIMER_ADDR A:0x786404c
y.create.l HWIO_SDC2_SDCC_MCI_VERSION_ADDR A:0x7864050
y.create.l HWIO_SDC2_SDCC_MCI_EMULATION_DLY_LINE_ADDR A:0x7864054
y.create.l HWIO_SDC2_SDCC_MCI_CCS_TIMER_ADDR A:0x7864058
y.create.l HWIO_SDC2_SDCC_MCI_RESPONSE_MASK_ADDR A:0x786405c
y.create.l HWIO_SDC2_SDCC_MCI_DLL_CONFIG_ADDR A:0x7864060
y.create.l HWIO_SDC2_SDCC_MCI_DLL_TEST_CTL_ADDR A:0x7864064
y.create.l HWIO_SDC2_SDCC_MCI_DLL_STATUS_ADDR A:0x7864068
y.create.l HWIO_SDC2_SDCC_MCI_STATUS2_ADDR A:0x786406c
y.create.l HWIO_SDC2_SDCC_MCI_GENERICS_ADDR A:0x7864070
y.create.l HWIO_SDC2_SDCC_MCI_FIFO_STATUS_ADDR A:0x7864074
y.create.l HWIO_SDC2_SDCC_MCI_HC_MODE_ADDR A:0x7864078
y.create.l HWIO_SDC2_SDCC_MCI_FIFO0_ADDR A:0x7864080
y.create.l HWIO_SDC2_SDCC_MCI_FIFO1_ADDR A:0x7864084
y.create.l HWIO_SDC2_SDCC_MCI_FIFO2_ADDR A:0x7864088
y.create.l HWIO_SDC2_SDCC_MCI_FIFO3_ADDR A:0x786408c
y.create.l HWIO_SDC2_SDCC_MCI_FIFO4_ADDR A:0x7864090
y.create.l HWIO_SDC2_SDCC_MCI_FIFO5_ADDR A:0x7864094
y.create.l HWIO_SDC2_SDCC_MCI_FIFO6_ADDR A:0x7864098
y.create.l HWIO_SDC2_SDCC_MCI_FIFO7_ADDR A:0x786409c
y.create.l HWIO_SDC2_SDCC_MCI_FIFO8_ADDR A:0x78640a0
y.create.l HWIO_SDC2_SDCC_MCI_FIFO9_ADDR A:0x78640a4
y.create.l HWIO_SDC2_SDCC_MCI_TESTBUS_CONFIG_ADDR A:0x78640cc
y.create.l HWIO_SDC2_SDCC_MCI_TEST_CTL_ADDR A:0x78640d0
y.create.l HWIO_SDC2_SDCC_MCI_TEST_INPUT_ADDR A:0x78640d4
y.create.l HWIO_SDC2_SDCC_MCI_TEST_OUT_ADDR A:0x78640d8
y.create.l HWIO_SDC2_SDCC_MCI_PWRCTL_STATUS_REG_ADDR A:0x78640dc
y.create.l HWIO_SDC2_SDCC_MCI_PWRCTL_MASK_REG_ADDR A:0x78640e0
y.create.l HWIO_SDC2_SDCC_MCI_PWRCTL_CLEAR_REG_ADDR A:0x78640e4
y.create.l HWIO_SDC2_SDCC_MCI_PWRCTL_CTL_REG_ADDR A:0x78640e8
y.create.l HWIO_SDC2_SDCC_MCI_CLEAR2_ADDR A:0x78640ec
y.create.l HWIO_SDC2_SDCC_MCI_INT_MASKINT2_0_ADDR A:0x78640f0
y.create.l HWIO_SDC2_SDCC_MCI_INT_MASKINT2_1_ADDR A:0x78640f4
y.create.l HWIO_SDC2_SDCC_CHAR_CFG_ADDR A:0x78640fc
y.create.l HWIO_SDC2_SDCC_CHAR_CMD_ADDR A:0x7864100
y.create.l HWIO_SDC2_SDCC_CHAR_DATA_0_ADDR A:0x7864104
y.create.l HWIO_SDC2_SDCC_CHAR_DATA_1_ADDR A:0x7864108
y.create.l HWIO_SDC2_SDCC_CHAR_DATA_2_ADDR A:0x786410c
y.create.l HWIO_SDC2_SDCC_CHAR_DATA_3_ADDR A:0x7864110
y.create.l HWIO_SDC2_SDCC_CHAR_DATA_4_ADDR A:0x7864114
y.create.l HWIO_SDC2_SDCC_CHAR_DATA_5_ADDR A:0x7864118
y.create.l HWIO_SDC2_SDCC_CHAR_DATA_6_ADDR A:0x786411c
y.create.l HWIO_SDC2_SDCC_CHAR_DATA_7_ADDR A:0x7864120
y.create.l HWIO_SDC2_SDCC_DEBUG_REG_ADDR A:0x7864124
y.create.l HWIO_SDC2_SDCC_IP_CATALOG_ADDR A:0x7864128
y.create.l HWIO_SDC2_SDCC_QSB_VALUES_ADDR A:0x786412c
y.create.l HWIO_SDC2_SDCC_QSB_AXI_VALUES_ADDR A:0x7864130
y.create.l HWIO_SDC2_SDCC_AXI_DATA_ERR_DBUG_ADDR A:0x7864134
y.create.l HWIO_SDC2_SDCC_T4_DLY_CTRL_ADDR A:0x7864138
y.create.l HWIO_SDC2_SDCC_T4_DLY_STAT_ADDR A:0x786413c
y.create.l HWIO_SDC2_SDCC_CSR_CDC_CTLR_CFG0_ADDR A:0x7864140
y.create.l HWIO_SDC2_SDCC_CSR_CDC_CTLR_CFG1_ADDR A:0x7864144
y.create.l HWIO_SDC2_SDCC_CSR_CDC_CAL_TIMER_CFG0_ADDR A:0x7864148
y.create.l HWIO_SDC2_SDCC_CSR_CDC_CAL_TIMER_CFG1_ADDR A:0x786414c
y.create.l HWIO_SDC2_SDCC_CSR_CDC_REFCOUNT_CFG_ADDR A:0x7864150
y.create.l HWIO_SDC2_SDCC_CSR_CDC_COARSE_CAL_CFG_ADDR A:0x7864154
y.create.l HWIO_SDC2_SDCC_CSR_CDC_RSVD_CFG_ADDR A:0x7864158
y.create.l HWIO_SDC2_SDCC_CSR_CDC_OFFSET_CFG_ADDR A:0x786415c
y.create.l HWIO_SDC2_SDCC_CSR_CDC_DELAY_CFG_ADDR A:0x7864160
y.create.l HWIO_SDC2_SDCC_CSR_CDC_SW_MODE_CFG_ADDR A:0x7864164
y.create.l HWIO_SDC2_SDCC_CSR_CDC_TEST_CFG_ADDR A:0x7864168
y.create.l HWIO_SDC2_SDCC_CSR_CDC_SW_OVRD_CFG_ADDR A:0x786416c
y.create.l HWIO_SDC2_SDCC_CSR_CDC_SLAVE_DDA_CFG_ADDR A:0x7864170
y.create.l HWIO_SDC2_SDCC_CSR_CDC_STATUS0_ADDR A:0x7864174
y.create.l HWIO_SDC2_SDCC_CSR_CDC_STATUS1_ADDR A:0x7864178
y.create.l HWIO_SDC2_SDCC_CSR_CDC_STATUS2_ADDR A:0x786417c
y.create.l HWIO_SDC2_SDCC_CSR_CDC_STATUS3_ADDR A:0x7864180
y.create.l HWIO_SDC2_SDCC_CSR_CDC_STATUS4_ADDR A:0x7864184
y.create.l HWIO_SDC2_SDCC_CSR_CDC_GEN_CFG_ADDR A:0x7864188
y.create.l HWIO_SDC2_SDCC_CDC_AUTO_SW_CAL_CFG_ADDR A:0x786418c
y.create.l HWIO_SDC2_SDCC_DDR200_STAT_ADDR A:0x7864190
y.create.l HWIO_SDC2_SDCC_DDR200_CFG_ADDR A:0x7864194
y.create.l HWIO_SDC2_SDCC_TIME_COUNT_CTRL_ADDR A:0x7864198
y.create.l HWIO_SDC2_SDCC_FLOW_CTRL_TIME_COUNT_ADDR A:0x786419c
y.create.l HWIO_SDC2_SDCC_BUSY_TIME_COUNT_ADDR A:0x78641a0
y.create.l HWIO_SDC2_SDCC_DATA_TIME_COUNT_ADDR A:0x78641a4
y.create.l HWIO_SDC2_SDCC_CMD_TIME_COUNT_ADDR A:0x78641a8
y.create.l HWIO_SDC2_SDCC_MCI_DLL_CONFIG_2_ADDR A:0x78641ac
y.create.l HWIO_SDC2_SDCC_MCI_DDR_CONFIG_ADDR A:0x78641b0
y.create.l HWIO_SDC2_SDCC_MCI_FIFO_ALT0_ADDR A:0x7864400
y.create.l HWIO_SDC2_SDCC_MCI_FIFO_ALT1_ADDR A:0x7864404
y.create.l HWIO_SDC2_SDCC_MCI_FIFO_ALT2_ADDR A:0x7864408
y.create.l HWIO_SDC2_SDCC_MCI_FIFO_ALT3_ADDR A:0x786440c
y.create.l HWIO_SDC2_SDCC_MCI_FIFO_ALT4_ADDR A:0x7864410
y.create.l HWIO_SDC2_SDCC_MCI_FIFO_ALT5_ADDR A:0x7864414
y.create.l HWIO_SDC2_SDCC_MCI_FIFO_ALT6_ADDR A:0x7864418
y.create.l HWIO_SDC2_SDCC_MCI_FIFO_ALT7_ADDR A:0x786441c
y.create.l HWIO_SDC2_SDCC_MCI_FIFO_ALT8_ADDR A:0x7864420
y.create.l HWIO_SDC2_SDCC_MCI_FIFO_ALT9_ADDR A:0x7864424
y.create.l HWIO_SDC2_SDCC_HC_REG_0_2_ADDR A:0x7864900
y.create.l HWIO_SDC2_SDCC_HC_REG_4_6_ADDR A:0x7864904
y.create.l HWIO_SDC2_SDCC_HC_REG_8_A_ADDR A:0x7864908
y.create.l HWIO_SDC2_SDCC_HC_REG_C_E_ADDR A:0x786490c
y.create.l HWIO_SDC2_SDCC_HC_REG_10_12_ADDR A:0x7864910
y.create.l HWIO_SDC2_SDCC_HC_REG_14_16_ADDR A:0x7864914
y.create.l HWIO_SDC2_SDCC_HC_REG_18_1A_ADDR A:0x7864918
y.create.l HWIO_SDC2_SDCC_HC_REG_1C_1E_ADDR A:0x786491c
y.create.l HWIO_SDC2_SDCC_HC_REG_20_22_ADDR A:0x7864920
y.create.l HWIO_SDC2_SDCC_HC_REG_24_26_ADDR A:0x7864924
y.create.l HWIO_SDC2_SDCC_HC_REG_28_2A_ADDR A:0x7864928
y.create.l HWIO_SDC2_SDCC_HC_REG_2C_2E_ADDR A:0x786492c
y.create.l HWIO_SDC2_SDCC_HC_REG_30_32_ADDR A:0x7864930
y.create.l HWIO_SDC2_SDCC_HC_REG_34_36_ADDR A:0x7864934
y.create.l HWIO_SDC2_SDCC_HC_REG_38_3A_ADDR A:0x7864938
y.create.l HWIO_SDC2_SDCC_HC_REG_3C_3E_ADDR A:0x786493c
y.create.l HWIO_SDC2_SDCC_HC_REG_40_42_ADDR A:0x7864940
y.create.l HWIO_SDC2_SDCC_HC_REG_44_46_ADDR A:0x7864944
y.create.l HWIO_SDC2_SDCC_HC_REG_48_4A_ADDR A:0x7864948
y.create.l HWIO_SDC2_SDCC_HC_REG_50_52_ADDR A:0x7864950
y.create.l HWIO_SDC2_SDCC_HC_REG_54_56_ADDR A:0x7864954
y.create.l HWIO_SDC2_SDCC_HC_REG_58_5A_ADDR A:0x7864958
y.create.l HWIO_SDC2_SDCC_HC_REG_5C_5E_ADDR A:0x786495c
y.create.l HWIO_SDC2_SDCC_HC_REG_60_62_ADDR A:0x7864960
y.create.l HWIO_SDC2_SDCC_HC_REG_64_66_ADDR A:0x7864964
y.create.l HWIO_SDC2_SDCC_HC_REG_68_6A_ADDR A:0x7864968
y.create.l HWIO_SDC2_SDCC_HC_REG_6C_6E_ADDR A:0x786496c
y.create.l HWIO_SDC2_SDCC_HC_REG_E0_E2_ADDR A:0x78649e0
y.create.l HWIO_SDC2_SDCC_HC_REG_FC_FE_ADDR A:0x78649fc
y.create.l HWIO_SDC2_SDCC_HC_REG_DLL_CONFIG_ADDR A:0x7864a00
y.create.l HWIO_SDC2_SDCC_HC_REG_DLL_TEST_CTL_ADDR A:0x7864a04
y.create.l HWIO_SDC2_SDCC_HC_REG_DLL_STATUS_ADDR A:0x7864a08
y.create.l HWIO_SDC2_SDCC_HC_VENDOR_SPECIFIC_FUNC_ADDR A:0x7864a0c
y.create.l HWIO_SDC2_SDCC_HC_VENDOR_SPECIFIC_FUNC2_ADDR A:0x7864a10
y.create.l HWIO_SDC2_SDCC_HC_VENDOR_SPECIFIC_ADMA_ERR_ADDR0_ADDR A:0x7864a14
y.create.l HWIO_SDC2_SDCC_HC_VENDOR_SPECIFIC_ADMA_ERR_ADDR1_ADDR A:0x7864a18
y.create.l HWIO_SDC2_SDCC_HC_VENDOR_SPECIFIC_CAPABILITIES0_ADDR A:0x7864a1c
y.create.l HWIO_SDC2_SDCC_HC_VENDOR_SPECIFIC_CAPABILITIES1_ADDR A:0x7864a20
y.create.l HWIO_SDC2_SDCC_HC_VENDOR_SPECIFIC_T4_DLY_CTRL_ADDR A:0x7864a24
y.create.l HWIO_SDC2_SDCC_HC_VENDOR_SPECIFIC_T4_DLY_STAT_ADDR A:0x7864a28
y.create.l HWIO_SDC2_SDCC_HC_VENDOR_SPECIFIC_CSR_CDC_CTLR_CFG0_ADDR A:0x7864a30
y.create.l HWIO_SDC2_SDCC_HC_VENDOR_SPECIFIC_CSR_CDC_CTLR_CFG1_ADDR A:0x7864a34
y.create.l HWIO_SDC2_SDCC_HC_VENDOR_SPECIFIC_CSR_CDC_CAL_TIMER_CFG0_ADDR A:0x7864a38
y.create.l HWIO_SDC2_SDCC_HC_VENDOR_SPECIFIC_CSR_CDC_CAL_TIMER_CFG1_ADDR A:0x7864a3c
y.create.l HWIO_SDC2_SDCC_HC_VENDOR_SPECIFIC_CSR_CDC_REFCOUNT_CFG_ADDR A:0x7864a40
y.create.l HWIO_SDC2_SDCC_HC_VENDOR_SPECIFIC_CSR_CDC_COARSE_CAL_CFG_ADDR A:0x7864a44
y.create.l HWIO_SDC2_SDCC_HC_VENDOR_SPECIFIC_CSR_CDC_RSVD_CFG_ADDR A:0x7864a48
y.create.l HWIO_SDC2_SDCC_HC_VENDOR_SPECIFIC_CSR_CDC_OFFSET_CFG_ADDR A:0x7864a4c
y.create.l HWIO_SDC2_SDCC_HC_VENDOR_SPECIFIC_CSR_CDC_DELAY_CFG_ADDR A:0x7864a50
y.create.l HWIO_SDC2_SDCC_HC_VENDOR_SPECIFIC_CSR_CDC_SW_MODE_CFG_ADDR A:0x7864a54
y.create.l HWIO_SDC2_SDCC_HC_VENDOR_SPECIFIC_CSR_CDC_TEST_CFG_ADDR A:0x7864a58
y.create.l HWIO_SDC2_SDCC_HC_VENDOR_SPECIFIC_CSR_CDC_SW_OVRD_CFG_ADDR A:0x7864a5c
y.create.l HWIO_SDC2_SDCC_HC_VENDOR_SPECIFIC_CSR_CDC_SLAVE_DDA_CFG_ADDR A:0x7864a60
y.create.l HWIO_SDC2_SDCC_HC_VENDOR_SPECIFIC_CSR_CDC_STATUS0_ADDR A:0x7864a64
y.create.l HWIO_SDC2_SDCC_HC_VENDOR_SPECIFIC_CSR_CDC_STATUS1_ADDR A:0x7864a68
y.create.l HWIO_SDC2_SDCC_HC_VENDOR_SPECIFIC_CSR_CDC_STATUS2_ADDR A:0x7864a6c
y.create.l HWIO_SDC2_SDCC_HC_VENDOR_SPECIFIC_CSR_CDC_STATUS3_ADDR A:0x7864a70
y.create.l HWIO_SDC2_SDCC_HC_VENDOR_SPECIFIC_CSR_CDC_STATUS4_ADDR A:0x7864a74
y.create.l HWIO_SDC2_SDCC_HC_VENDOR_SPECIFIC_CSR_CDC_GEN_CFG_ADDR A:0x7864a78
y.create.l HWIO_SDC2_SDCC_HC_VENDOR_SPECIFIC_CDC_AUTO_SW_CAL_CFG_ADDR A:0x7864a7c
y.create.l HWIO_SDC2_SDCC_HC_VENDOR_SPECIFIC_DDR200_STAT_ADDR A:0x7864a80
y.create.l HWIO_SDC2_SDCC_HC_VENDOR_SPECIFIC_DDR200_CFG_ADDR A:0x7864a84
y.create.l HWIO_SDC2_SDCC_HC_VENDOR_SPECIFIC_TIME_COUNT_CTRL_ADDR A:0x7864a88
y.create.l HWIO_SDC2_SDCC_HC_VENDOR_SPECIFIC_FLOW_CTRL_TIME_COUNT_ADDR A:0x7864a8c
y.create.l HWIO_SDC2_SDCC_HC_VENDOR_SPECIFIC_BUSY_TIME_COUNT_ADDR A:0x7864a90
y.create.l HWIO_SDC2_SDCC_HC_VENDOR_SPECIFIC_DATA_TIME_COUNT_ADDR A:0x7864a94
y.create.l HWIO_SDC2_SDCC_HC_VENDOR_SPECIFIC_CMD_TIME_COUNT_ADDR A:0x7864a98
y.create.l HWIO_SDC2_SDCC_HC_VENDOR_SPECIFIC_ERR_INT_STS_ADDR A:0x7864a9c
y.create.l HWIO_SDC2_SDCC_HC_VENDOR_SPECIFIC_PWRCTL_STATUS_REG_ADDR A:0x7864aa0
y.create.l HWIO_SDC2_SDCC_HC_VENDOR_SPECIFIC_PWRCTL_MASK_REG_ADDR A:0x7864aa4
y.create.l HWIO_SDC2_SDCC_HC_VENDOR_SPECIFIC_PWRCTL_CLEAR_REG_ADDR A:0x7864aa8
y.create.l HWIO_SDC2_SDCC_HC_VENDOR_SPECIFIC_PWRCTL_CTL_REG_ADDR A:0x7864aac
y.create.l HWIO_SDC2_SDCC_HC_VENDOR_SPECIFIC_FUNC3_ADDR A:0x7864ab0
y.create.l HWIO_SDC2_SDCC_HC_REG_DLL_CONFIG_2_ADDR A:0x7864ab4
y.create.l HWIO_SDC2_SDCC_HC_REG_DDR_CONFIG_ADDR A:0x7864ab8
y.create.l HWIO_QFPROM_RAW_CRI_CM_PRIVATE0_ADDR A:0xa0000
y.create.l HWIO_QFPROM_RAW_CRI_CM_PRIVATE1_ADDR A:0xa0004
y.create.l HWIO_QFPROM_RAW_CRI_CM_PRIVATE2_ADDR A:0xa0008
y.create.l HWIO_QFPROM_RAW_CRI_CM_PRIVATE3_ADDR A:0xa000c
y.create.l HWIO_QFPROM_RAW_CRI_CM_PRIVATE4_ADDR A:0xa0010
y.create.l HWIO_QFPROM_RAW_CRI_CM_PRIVATE5_ADDR A:0xa0014
y.create.l HWIO_QFPROM_RAW_CRI_CM_PRIVATE6_ADDR A:0xa0018
y.create.l HWIO_QFPROM_RAW_CRI_CM_PRIVATE7_ADDR A:0xa001c
y.create.l HWIO_QFPROM_RAW_CRI_CM_PRIVATE8_ADDR A:0xa0020
y.create.l HWIO_QFPROM_RAW_CRI_CM_PRIVATE9_ADDR A:0xa0024
y.create.l HWIO_QFPROM_RAW_JTAG_ID_ADDR A:0xa0120
y.create.l HWIO_QFPROM_RAW_PTE1_ADDR A:0xa0124
y.create.l HWIO_QFPROM_RAW_SERIAL_NUM_ADDR A:0xa0128
y.create.l HWIO_QFPROM_RAW_PTE2_ADDR A:0xa012c
y.create.l HWIO_QFPROM_RAW_RD_WR_PERM_LSB_ADDR A:0xa0130
y.create.l HWIO_QFPROM_RAW_RD_WR_PERM_MSB_ADDR A:0xa0134
y.create.l HWIO_QFPROM_RAW_ANTI_ROLLBACK_1_LSB_ADDR A:0xa0138
y.create.l HWIO_QFPROM_RAW_ANTI_ROLLBACK_1_MSB_ADDR A:0xa013c
y.create.l HWIO_QFPROM_RAW_ANTI_ROLLBACK_2_LSB_ADDR A:0xa0140
y.create.l HWIO_QFPROM_RAW_ANTI_ROLLBACK_2_MSB_ADDR A:0xa0144
y.create.l HWIO_QFPROM_RAW_ANTI_ROLLBACK_3_LSB_ADDR A:0xa0148
y.create.l HWIO_QFPROM_RAW_ANTI_ROLLBACK_3_MSB_ADDR A:0xa014c
y.create.l HWIO_QFPROM_RAW_OEM_CONFIG_ROW0_LSB_ADDR A:0xa0150
y.create.l HWIO_QFPROM_RAW_OEM_CONFIG_ROW0_MSB_ADDR A:0xa0154
y.create.l HWIO_QFPROM_RAW_OEM_CONFIG_ROW1_LSB_ADDR A:0xa0158
y.create.l HWIO_QFPROM_RAW_OEM_CONFIG_ROW1_MSB_ADDR A:0xa015c
y.create.l HWIO_QFPROM_RAW_FEAT_CONFIG_ROW0_LSB_ADDR A:0xa0160
y.create.l HWIO_QFPROM_RAW_FEAT_CONFIG_ROW0_MSB_ADDR A:0xa0164
y.create.l HWIO_QFPROM_RAW_FEAT_CONFIG_ROW1_LSB_ADDR A:0xa0168
y.create.l HWIO_QFPROM_RAW_FEAT_CONFIG_ROW1_MSB_ADDR A:0xa016c
y.create.l HWIO_QFPROM_RAW_FEAT_CONFIG_ROW2_LSB_ADDR A:0xa0170
y.create.l HWIO_QFPROM_RAW_FEAT_CONFIG_ROW2_MSB_ADDR A:0xa0174
y.create.l HWIO_QFPROM_RAW_CM_FEAT_CONFIG_ROW0_LSB_ADDR A:0xa0178
y.create.l HWIO_QFPROM_RAW_CM_FEAT_CONFIG_ROW0_MSB_ADDR A:0xa017c
y.create.l HWIO_QFPROM_RAW_CM_FEAT_CONFIG_ROW1_LSB_ADDR A:0xa0180
y.create.l HWIO_QFPROM_RAW_CM_FEAT_CONFIG_ROW1_MSB_ADDR A:0xa0184
y.create.l HWIO_QFPROM_RAW_CM_FEAT_CONFIG_ROW2_LSB_ADDR A:0xa0188
y.create.l HWIO_QFPROM_RAW_CM_FEAT_CONFIG_ROW2_MSB_ADDR A:0xa018c
y.create.l HWIO_QFPROM_RAW_PRI_KEY_DERIVATION_KEY_ROW0_LSB_ADDR A:0xa0190
y.create.l HWIO_QFPROM_RAW_PRI_KEY_DERIVATION_KEY_ROW1_LSB_ADDR A:0xa0198
y.create.l HWIO_QFPROM_RAW_PRI_KEY_DERIVATION_KEY_ROW2_LSB_ADDR A:0xa01a0
y.create.l HWIO_QFPROM_RAW_PRI_KEY_DERIVATION_KEY_ROW3_LSB_ADDR A:0xa01a8
y.create.l HWIO_QFPROM_RAW_PRI_KEY_DERIVATION_KEY_ROW0_MSB_ADDR A:0xa0194
y.create.l HWIO_QFPROM_RAW_PRI_KEY_DERIVATION_KEY_ROW1_MSB_ADDR A:0xa019c
y.create.l HWIO_QFPROM_RAW_PRI_KEY_DERIVATION_KEY_ROW2_MSB_ADDR A:0xa01a4
y.create.l HWIO_QFPROM_RAW_PRI_KEY_DERIVATION_KEY_ROW3_MSB_ADDR A:0xa01ac
y.create.l HWIO_QFPROM_RAW_SEC_KEY_DERIVATION_KEY_ROW0_LSB_ADDR A:0xa01b0
y.create.l HWIO_QFPROM_RAW_SEC_KEY_DERIVATION_KEY_ROW1_LSB_ADDR A:0xa01b8
y.create.l HWIO_QFPROM_RAW_SEC_KEY_DERIVATION_KEY_ROW2_LSB_ADDR A:0xa01c0
y.create.l HWIO_QFPROM_RAW_SEC_KEY_DERIVATION_KEY_ROW3_LSB_ADDR A:0xa01c8
y.create.l HWIO_QFPROM_RAW_SEC_KEY_DERIVATION_KEY_ROW0_MSB_ADDR A:0xa01b4
y.create.l HWIO_QFPROM_RAW_SEC_KEY_DERIVATION_KEY_ROW1_MSB_ADDR A:0xa01bc
y.create.l HWIO_QFPROM_RAW_SEC_KEY_DERIVATION_KEY_ROW2_MSB_ADDR A:0xa01c4
y.create.l HWIO_QFPROM_RAW_SEC_KEY_DERIVATION_KEY_ROW3_MSB_ADDR A:0xa01cc
y.create.l HWIO_QFPROM_RAW_OEM_SEC_BOOT_ROW0_LSB_ADDR A:0xa01d0
y.create.l HWIO_QFPROM_RAW_OEM_SEC_BOOT_ROW0_MSB_ADDR A:0xa01d4
y.create.l HWIO_QFPROM_RAW_CALIB2_ROW0_LSB_ADDR A:0xa01d8
y.create.l HWIO_QFPROM_RAW_CALIB2_ROW0_MSB_ADDR A:0xa01dc
y.create.l HWIO_QFPROM_RAW_PK_HASH_ROW0_LSB_ADDR A:0xa01e0
y.create.l HWIO_QFPROM_RAW_PK_HASH_ROW1_LSB_ADDR A:0xa01e8
y.create.l HWIO_QFPROM_RAW_PK_HASH_ROW2_LSB_ADDR A:0xa01f0
y.create.l HWIO_QFPROM_RAW_PK_HASH_ROW3_LSB_ADDR A:0xa01f8
y.create.l HWIO_QFPROM_RAW_PK_HASH_ROW0_MSB_ADDR A:0xa01e4
y.create.l HWIO_QFPROM_RAW_PK_HASH_ROW1_MSB_ADDR A:0xa01ec
y.create.l HWIO_QFPROM_RAW_PK_HASH_ROW2_MSB_ADDR A:0xa01f4
y.create.l HWIO_QFPROM_RAW_PK_HASH_ROW3_MSB_ADDR A:0xa01fc
y.create.l HWIO_QFPROM_RAW_PK_HASH_ROW4_LSB_ADDR A:0xa0200
y.create.l HWIO_QFPROM_RAW_PK_HASH_ROW4_MSB_ADDR A:0xa0204
y.create.l HWIO_QFPROM_RAW_CALIB_ROW0_LSB_ADDR A:0xa0208
y.create.l HWIO_QFPROM_RAW_CALIB_ROW0_MSB_ADDR A:0xa020c
y.create.l HWIO_QFPROM_RAW_CALIB_ROW1_LSB_ADDR A:0xa0210
y.create.l HWIO_QFPROM_RAW_CALIB_ROW1_MSB_ADDR A:0xa0214
y.create.l HWIO_QFPROM_RAW_CALIB_ROW2_LSB_ADDR A:0xa0218
y.create.l HWIO_QFPROM_RAW_CALIB_ROW2_MSB_ADDR A:0xa021c
y.create.l HWIO_QFPROM_RAW_CALIB_ROW3_LSB_ADDR A:0xa0220
y.create.l HWIO_QFPROM_RAW_CALIB_ROW3_MSB_ADDR A:0xa0224
y.create.l HWIO_QFPROM_RAW_CALIB_ROW4_LSB_ADDR A:0xa0228
y.create.l HWIO_QFPROM_RAW_CALIB_ROW4_MSB_ADDR A:0xa022c
y.create.l HWIO_QFPROM_RAW_CALIB_ROW5_LSB_ADDR A:0xa0230
y.create.l HWIO_QFPROM_RAW_CALIB_ROW5_MSB_ADDR A:0xa0234
y.create.l HWIO_QFPROM_RAW_CALIB_ROW6_LSB_ADDR A:0xa0238
y.create.l HWIO_QFPROM_RAW_CALIB_ROW6_MSB_ADDR A:0xa023c
y.create.l HWIO_QFPROM_RAW_CALIB_ROW7_LSB_ADDR A:0xa0240
y.create.l HWIO_QFPROM_RAW_CALIB_ROW7_MSB_ADDR A:0xa0244
y.create.l HWIO_QFPROM_RAW_CALIB_ROW8_LSB_ADDR A:0xa0248
y.create.l HWIO_QFPROM_RAW_CALIB_ROW8_MSB_ADDR A:0xa024c
y.create.l HWIO_QFPROM_RAW_CALIB_ROW9_LSB_ADDR A:0xa0250
y.create.l HWIO_QFPROM_RAW_CALIB_ROW9_MSB_ADDR A:0xa0254
y.create.l HWIO_QFPROM_RAW_MEM_CONFIG_ROW0_LSB_ADDR A:0xa0258
y.create.l HWIO_QFPROM_RAW_MEM_CONFIG_ROW1_LSB_ADDR A:0xa0260
y.create.l HWIO_QFPROM_RAW_MEM_CONFIG_ROW2_LSB_ADDR A:0xa0268
y.create.l HWIO_QFPROM_RAW_MEM_CONFIG_ROW3_LSB_ADDR A:0xa0270
y.create.l HWIO_QFPROM_RAW_MEM_CONFIG_ROW4_LSB_ADDR A:0xa0278
y.create.l HWIO_QFPROM_RAW_MEM_CONFIG_ROW5_LSB_ADDR A:0xa0280
y.create.l HWIO_QFPROM_RAW_MEM_CONFIG_ROW6_LSB_ADDR A:0xa0288
y.create.l HWIO_QFPROM_RAW_MEM_CONFIG_ROW7_LSB_ADDR A:0xa0290
y.create.l HWIO_QFPROM_RAW_MEM_CONFIG_ROW8_LSB_ADDR A:0xa0298
y.create.l HWIO_QFPROM_RAW_MEM_CONFIG_ROW0_MSB_ADDR A:0xa025c
y.create.l HWIO_QFPROM_RAW_MEM_CONFIG_ROW1_MSB_ADDR A:0xa0264
y.create.l HWIO_QFPROM_RAW_MEM_CONFIG_ROW2_MSB_ADDR A:0xa026c
y.create.l HWIO_QFPROM_RAW_MEM_CONFIG_ROW3_MSB_ADDR A:0xa0274
y.create.l HWIO_QFPROM_RAW_MEM_CONFIG_ROW4_MSB_ADDR A:0xa027c
y.create.l HWIO_QFPROM_RAW_MEM_CONFIG_ROW5_MSB_ADDR A:0xa0284
y.create.l HWIO_QFPROM_RAW_MEM_CONFIG_ROW6_MSB_ADDR A:0xa028c
y.create.l HWIO_QFPROM_RAW_MEM_CONFIG_ROW7_MSB_ADDR A:0xa0294
y.create.l HWIO_QFPROM_RAW_MEM_CONFIG_ROW8_MSB_ADDR A:0xa029c
y.create.l HWIO_QFPROM_RAW_MEM_CONFIG_ROW9_LSB_ADDR A:0xa02a0
y.create.l HWIO_QFPROM_RAW_MEM_CONFIG_ROW9_MSB_ADDR A:0xa02a4
y.create.l HWIO_QFPROM_RAW_MEM_CONFIG_ROW10_LSB_ADDR A:0xa02a8
y.create.l HWIO_QFPROM_RAW_MEM_CONFIG_ROW10_MSB_ADDR A:0xa02ac
y.create.l HWIO_QFPROM_RAW_ROM_PATCH_ROW0_LSB_ADDR A:0xa02b0
y.create.l HWIO_QFPROM_RAW_ROM_PATCH_ROW1_LSB_ADDR A:0xa02b8
y.create.l HWIO_QFPROM_RAW_ROM_PATCH_ROW2_LSB_ADDR A:0xa02c0
y.create.l HWIO_QFPROM_RAW_ROM_PATCH_ROW3_LSB_ADDR A:0xa02c8
y.create.l HWIO_QFPROM_RAW_ROM_PATCH_ROW4_LSB_ADDR A:0xa02d0
y.create.l HWIO_QFPROM_RAW_ROM_PATCH_ROW5_LSB_ADDR A:0xa02d8
y.create.l HWIO_QFPROM_RAW_ROM_PATCH_ROW6_LSB_ADDR A:0xa02e0
y.create.l HWIO_QFPROM_RAW_ROM_PATCH_ROW7_LSB_ADDR A:0xa02e8
y.create.l HWIO_QFPROM_RAW_ROM_PATCH_ROW8_LSB_ADDR A:0xa02f0
y.create.l HWIO_QFPROM_RAW_ROM_PATCH_ROW9_LSB_ADDR A:0xa02f8
y.create.l HWIO_QFPROM_RAW_ROM_PATCH_ROW0_MSB_ADDR A:0xa02b4
y.create.l HWIO_QFPROM_RAW_ROM_PATCH_ROW1_MSB_ADDR A:0xa02bc
y.create.l HWIO_QFPROM_RAW_ROM_PATCH_ROW2_MSB_ADDR A:0xa02c4
y.create.l HWIO_QFPROM_RAW_ROM_PATCH_ROW3_MSB_ADDR A:0xa02cc
y.create.l HWIO_QFPROM_RAW_ROM_PATCH_ROW4_MSB_ADDR A:0xa02d4
y.create.l HWIO_QFPROM_RAW_ROM_PATCH_ROW5_MSB_ADDR A:0xa02dc
y.create.l HWIO_QFPROM_RAW_ROM_PATCH_ROW6_MSB_ADDR A:0xa02e4
y.create.l HWIO_QFPROM_RAW_ROM_PATCH_ROW7_MSB_ADDR A:0xa02ec
y.create.l HWIO_QFPROM_RAW_ROM_PATCH_ROW8_MSB_ADDR A:0xa02f4
y.create.l HWIO_QFPROM_RAW_ROM_PATCH_ROW9_MSB_ADDR A:0xa02fc
y.create.l HWIO_QFPROM_RAW_FEC_EN_LSB_ADDR A:0xa03b0
y.create.l HWIO_QFPROM_RAW_FEC_EN_MSB_ADDR A:0xa03b4
y.create.l HWIO_QFPROM_RAW_SPARE_REG18_LSB_ADDR A:0xa03b8
y.create.l HWIO_QFPROM_RAW_SPARE_REG18_MSB_ADDR A:0xa03bc
y.create.l HWIO_QFPROM_RAW_SPARE_REG19_LSB_ADDR A:0xa03c0
y.create.l HWIO_QFPROM_RAW_SPARE_REG19_MSB_ADDR A:0xa03c4
y.create.l HWIO_QFPROM_RAW_SPARE_REG20_LSB_ADDR A:0xa03c8
y.create.l HWIO_QFPROM_RAW_SPARE_REG20_MSB_ADDR A:0xa03cc
y.create.l HWIO_QFPROM_RAW_SPARE_REG21_LSB_ADDR A:0xa03d0
y.create.l HWIO_QFPROM_RAW_SPARE_REG21_MSB_ADDR A:0xa03d4
y.create.l HWIO_QFPROM_RAW_SPARE_REG22_LSB_ADDR A:0xa03d8
y.create.l HWIO_QFPROM_RAW_SPARE_REG22_MSB_ADDR A:0xa03dc
y.create.l HWIO_QFPROM_RAW_SPARE_REG23_LSB_ADDR A:0xa03e0
y.create.l HWIO_QFPROM_RAW_SPARE_REG23_MSB_ADDR A:0xa03e4
y.create.l HWIO_QFPROM_RAW_SPARE_REG24_LSB_ADDR A:0xa03e8
y.create.l HWIO_QFPROM_RAW_SPARE_REG24_MSB_ADDR A:0xa03ec
y.create.l HWIO_QFPROM_RAW_SPARE_REG25_LSB_ADDR A:0xa03f0
y.create.l HWIO_QFPROM_RAW_SPARE_REG25_MSB_ADDR A:0xa03f4
y.create.l HWIO_QFPROM_RAW_SPARE_REG26_LSB_ADDR A:0xa03f8
y.create.l HWIO_QFPROM_RAW_SPARE_REG26_MSB_ADDR A:0xa03fc
y.create.l HWIO_QFPROM_RAW_ACC_PRIVATE0_ADDR A:0xa0800
y.create.l HWIO_QFPROM_RAW_ACC_PRIVATE1_ADDR A:0xa0804
y.create.l HWIO_QFPROM_RAW_ACC_PRIVATE2_ADDR A:0xa0808
y.create.l HWIO_QFPROM_RAW_ACC_PRIVATE3_ADDR A:0xa080c
y.create.l HWIO_QFPROM_RAW_ACC_PRIVATE4_ADDR A:0xa0810
y.create.l HWIO_QFPROM_RAW_ACC_PRIVATE5_ADDR A:0xa0814
y.create.l HWIO_QFPROM_RAW_ACC_PRIVATE6_ADDR A:0xa0818
y.create.l HWIO_QFPROM_RAW_ACC_PRIVATE7_ADDR A:0xa081c
y.create.l HWIO_QFPROM_RAW_ACC_PRIVATE8_ADDR A:0xa0820
y.create.l HWIO_QFPROM_RAW_ACC_PRIVATE9_ADDR A:0xa0824
y.create.l HWIO_ACC_IR_ADDR A:0xa2000
y.create.l HWIO_ACC_DR_ADDR A:0xa2004
y.create.l HWIO_ACC_VERID_ADDR A:0xa2008
y.create.l HWIO_ACC_FEATSET0_ADDR A:0xa2010
y.create.l HWIO_ACC_FEATSET1_ADDR A:0xa2014
y.create.l HWIO_ACC_FEATSET2_ADDR A:0xa2018
y.create.l HWIO_ACC_FEATSET3_ADDR A:0xa201c
y.create.l HWIO_ACC_FEATSET4_ADDR A:0xa2020
y.create.l HWIO_ACC_FEATSET5_ADDR A:0xa2024
y.create.l HWIO_ACC_FEATSET6_ADDR A:0xa2028
y.create.l HWIO_ACC_FEATSET7_ADDR A:0xa202c
y.create.l HWIO_ACC_STATE_ADDR A:0xa2038
y.create.l HWIO_QFPROM_BLOW_TIMER_ADDR A:0xa203c
y.create.l HWIO_QFPROM_TEST_CTRL_ADDR A:0xa2040
y.create.l HWIO_QFPROM_ACCEL_ADDR A:0xa2044
y.create.l HWIO_QFPROM_BLOW_STATUS_ADDR A:0xa2048
y.create.l HWIO_QFPROM_ROM_ERROR_ADDR A:0xa204c
y.create.l HWIO_QFPROM_BIST_CTRL_ADDR A:0xa2050
y.create.l HWIO_QFPROM_BIST_ERROR_ADDR A:0xa2054
y.create.l HWIO_QFPROM_HASH_SIGNATURE0_ADDR A:0xa2060
y.create.l HWIO_QFPROM_HASH_SIGNATURE1_ADDR A:0xa2064
y.create.l HWIO_QFPROM_HASH_SIGNATURE2_ADDR A:0xa2068
y.create.l HWIO_QFPROM_HASH_SIGNATURE3_ADDR A:0xa206c
y.create.l HWIO_QFPROM_HASH_SIGNATURE4_ADDR A:0xa2070
y.create.l HWIO_QFPROM_HASH_SIGNATURE5_ADDR A:0xa2074
y.create.l HWIO_QFPROM_HASH_SIGNATURE6_ADDR A:0xa2078
y.create.l HWIO_QFPROM_HASH_SIGNATURE7_ADDR A:0xa207c
y.create.l HWIO_HW_KEY_STATUS_ADDR A:0xa2080
y.create.l HWIO_RESET_JDR_STATUS_ADDR A:0xa2084
y.create.l HWIO_FEC_ESR_ADDR A:0xa2090
y.create.l HWIO_FEC_EAR_ADDR A:0xa2094
y.create.l HWIO_QFPROM0_MATCH_STATUS_ADDR A:0xa2098
y.create.l HWIO_QFPROM1_MATCH_STATUS_ADDR A:0xa209c
y.create.l HWIO_FEAT_PROV_OUT0_ADDR A:0xa20a0
y.create.l HWIO_FEAT_PROV_OUT1_ADDR A:0xa20a4
y.create.l HWIO_FEAT_PROV_OUT2_ADDR A:0xa20a8
y.create.l HWIO_FEAT_PROV_OUT3_ADDR A:0xa20ac
y.create.l HWIO_SEC_CTRL_MISC_CONFIG_STATUS0_ADDR A:0xa20b0
y.create.l HWIO_SEC_CTRL_MISC_CONFIG_STATUS1_ADDR A:0xa20b4
y.create.l HWIO_SEC_CTRL_MISC_CONFIG_STATUS2_ADDR A:0xa20b8
y.create.l HWIO_SEC_CTRL_MISC_CONFIG_STATUS3_ADDR A:0xa20bc
y.create.l HWIO_QFPROM_CORR_CRI_CM_PRIVATE0_ADDR A:0xa4000
y.create.l HWIO_QFPROM_CORR_CRI_CM_PRIVATE1_ADDR A:0xa4004
y.create.l HWIO_QFPROM_CORR_CRI_CM_PRIVATE2_ADDR A:0xa4008
y.create.l HWIO_QFPROM_CORR_CRI_CM_PRIVATE3_ADDR A:0xa400c
y.create.l HWIO_QFPROM_CORR_CRI_CM_PRIVATE4_ADDR A:0xa4010
y.create.l HWIO_QFPROM_CORR_CRI_CM_PRIVATE5_ADDR A:0xa4014
y.create.l HWIO_QFPROM_CORR_CRI_CM_PRIVATE6_ADDR A:0xa4018
y.create.l HWIO_QFPROM_CORR_CRI_CM_PRIVATE7_ADDR A:0xa401c
y.create.l HWIO_QFPROM_CORR_CRI_CM_PRIVATE8_ADDR A:0xa4020
y.create.l HWIO_QFPROM_CORR_CRI_CM_PRIVATE9_ADDR A:0xa4024
y.create.l HWIO_QFPROM_CORR_JTAG_ID_ADDR A:0xa4120
y.create.l HWIO_QFPROM_CORR_PTE1_ADDR A:0xa4124
y.create.l HWIO_QFPROM_CORR_SERIAL_NUM_ADDR A:0xa4128
y.create.l HWIO_QFPROM_CORR_PTE2_ADDR A:0xa412c
y.create.l HWIO_QFPROM_CORR_RD_WR_PERM_LSB_ADDR A:0xa4130
y.create.l HWIO_QFPROM_CORR_RD_WR_PERM_MSB_ADDR A:0xa4134
y.create.l HWIO_QFPROM_CORR_ANTI_ROLLBACK_1_LSB_ADDR A:0xa4138
y.create.l HWIO_QFPROM_CORR_ANTI_ROLLBACK_1_MSB_ADDR A:0xa413c
y.create.l HWIO_QFPROM_CORR_ANTI_ROLLBACK_2_LSB_ADDR A:0xa4140
y.create.l HWIO_QFPROM_CORR_ANTI_ROLLBACK_2_MSB_ADDR A:0xa4144
y.create.l HWIO_QFPROM_CORR_ANTI_ROLLBACK_3_LSB_ADDR A:0xa4148
y.create.l HWIO_QFPROM_CORR_ANTI_ROLLBACK_3_MSB_ADDR A:0xa414c
y.create.l HWIO_QFPROM_CORR_OEM_CONFIG_ROW0_LSB_ADDR A:0xa4150
y.create.l HWIO_QFPROM_CORR_OEM_CONFIG_ROW0_MSB_ADDR A:0xa4154
y.create.l HWIO_QFPROM_CORR_OEM_CONFIG_ROW1_LSB_ADDR A:0xa4158
y.create.l HWIO_QFPROM_CORR_OEM_CONFIG_ROW1_MSB_ADDR A:0xa415c
y.create.l HWIO_QFPROM_CORR_FEAT_CONFIG_ROW0_LSB_ADDR A:0xa4160
y.create.l HWIO_QFPROM_CORR_FEAT_CONFIG_ROW0_MSB_ADDR A:0xa4164
y.create.l HWIO_QFPROM_CORR_FEAT_CONFIG_ROW1_LSB_ADDR A:0xa4168
y.create.l HWIO_QFPROM_CORR_FEAT_CONFIG_ROW1_MSB_ADDR A:0xa416c
y.create.l HWIO_QFPROM_CORR_FEAT_CONFIG_ROW2_LSB_ADDR A:0xa4170
y.create.l HWIO_QFPROM_CORR_FEAT_CONFIG_ROW2_MSB_ADDR A:0xa4174
y.create.l HWIO_QFPROM_CORR_CM_FEAT_CONFIG_ROW0_LSB_ADDR A:0xa4178
y.create.l HWIO_QFPROM_CORR_CM_FEAT_CONFIG_ROW0_MSB_ADDR A:0xa417c
y.create.l HWIO_QFPROM_CORR_CM_FEAT_CONFIG_ROW1_LSB_ADDR A:0xa4180
y.create.l HWIO_QFPROM_CORR_CM_FEAT_CONFIG_ROW1_MSB_ADDR A:0xa4184
y.create.l HWIO_QFPROM_CORR_CM_FEAT_CONFIG_ROW2_LSB_ADDR A:0xa4188
y.create.l HWIO_QFPROM_CORR_CM_FEAT_CONFIG_ROW2_MSB_ADDR A:0xa418c
y.create.l HWIO_QFPROM_CORR_PRI_KEY_DERIVATION_KEY_ROW0_LSB_ADDR A:0xa4190
y.create.l HWIO_QFPROM_CORR_PRI_KEY_DERIVATION_KEY_ROW1_LSB_ADDR A:0xa4198
y.create.l HWIO_QFPROM_CORR_PRI_KEY_DERIVATION_KEY_ROW2_LSB_ADDR A:0xa41a0
y.create.l HWIO_QFPROM_CORR_PRI_KEY_DERIVATION_KEY_ROW3_LSB_ADDR A:0xa41a8
y.create.l HWIO_QFPROM_CORR_PRI_KEY_DERIVATION_KEY_ROW0_MSB_ADDR A:0xa4194
y.create.l HWIO_QFPROM_CORR_PRI_KEY_DERIVATION_KEY_ROW1_MSB_ADDR A:0xa419c
y.create.l HWIO_QFPROM_CORR_PRI_KEY_DERIVATION_KEY_ROW2_MSB_ADDR A:0xa41a4
y.create.l HWIO_QFPROM_CORR_PRI_KEY_DERIVATION_KEY_ROW3_MSB_ADDR A:0xa41ac
y.create.l HWIO_QFPROM_CORR_SEC_KEY_DERIVATION_KEY_ROW0_LSB_ADDR A:0xa41b0
y.create.l HWIO_QFPROM_CORR_SEC_KEY_DERIVATION_KEY_ROW1_LSB_ADDR A:0xa41b8
y.create.l HWIO_QFPROM_CORR_SEC_KEY_DERIVATION_KEY_ROW2_LSB_ADDR A:0xa41c0
y.create.l HWIO_QFPROM_CORR_SEC_KEY_DERIVATION_KEY_ROW3_LSB_ADDR A:0xa41c8
y.create.l HWIO_QFPROM_CORR_SEC_KEY_DERIVATION_KEY_ROW0_MSB_ADDR A:0xa41b4
y.create.l HWIO_QFPROM_CORR_SEC_KEY_DERIVATION_KEY_ROW1_MSB_ADDR A:0xa41bc
y.create.l HWIO_QFPROM_CORR_SEC_KEY_DERIVATION_KEY_ROW2_MSB_ADDR A:0xa41c4
y.create.l HWIO_QFPROM_CORR_SEC_KEY_DERIVATION_KEY_ROW3_MSB_ADDR A:0xa41cc
y.create.l HWIO_QFPROM_CORR_OEM_SEC_BOOT_ROW0_LSB_ADDR A:0xa41d0
y.create.l HWIO_QFPROM_CORR_OEM_SEC_BOOT_ROW0_MSB_ADDR A:0xa41d4
y.create.l HWIO_QFPROM_CORR_CALIB2_ROW0_LSB_ADDR A:0xa41d8
y.create.l HWIO_QFPROM_CORR_CALIB2_ROW0_MSB_ADDR A:0xa41dc
y.create.l HWIO_QFPROM_CORR_PK_HASH_ROW0_LSB_ADDR A:0xa41e0
y.create.l HWIO_QFPROM_CORR_PK_HASH_ROW1_LSB_ADDR A:0xa41e8
y.create.l HWIO_QFPROM_CORR_PK_HASH_ROW2_LSB_ADDR A:0xa41f0
y.create.l HWIO_QFPROM_CORR_PK_HASH_ROW3_LSB_ADDR A:0xa41f8
y.create.l HWIO_QFPROM_CORR_PK_HASH_ROW0_MSB_ADDR A:0xa41e4
y.create.l HWIO_QFPROM_CORR_PK_HASH_ROW1_MSB_ADDR A:0xa41ec
y.create.l HWIO_QFPROM_CORR_PK_HASH_ROW2_MSB_ADDR A:0xa41f4
y.create.l HWIO_QFPROM_CORR_PK_HASH_ROW3_MSB_ADDR A:0xa41fc
y.create.l HWIO_QFPROM_CORR_PK_HASH_ROW4_LSB_ADDR A:0xa4200
y.create.l HWIO_QFPROM_CORR_PK_HASH_ROW4_MSB_ADDR A:0xa4204
y.create.l HWIO_QFPROM_CORR_CALIB_ROW0_LSB_ADDR A:0xa4208
y.create.l HWIO_QFPROM_CORR_CALIB_ROW0_MSB_ADDR A:0xa420c
y.create.l HWIO_QFPROM_CORR_CALIB_ROW1_LSB_ADDR A:0xa4210
y.create.l HWIO_QFPROM_CORR_CALIB_ROW1_MSB_ADDR A:0xa4214
y.create.l HWIO_QFPROM_CORR_CALIB_ROW2_LSB_ADDR A:0xa4218
y.create.l HWIO_QFPROM_CORR_CALIB_ROW2_MSB_ADDR A:0xa421c
y.create.l HWIO_QFPROM_CORR_CALIB_ROW3_LSB_ADDR A:0xa4220
y.create.l HWIO_QFPROM_CORR_CALIB_ROW3_MSB_ADDR A:0xa4224
y.create.l HWIO_QFPROM_CORR_CALIB_ROW4_LSB_ADDR A:0xa4228
y.create.l HWIO_QFPROM_CORR_CALIB_ROW4_MSB_ADDR A:0xa422c
y.create.l HWIO_QFPROM_CORR_CALIB_ROW5_LSB_ADDR A:0xa4230
y.create.l HWIO_QFPROM_CORR_CALIB_ROW5_MSB_ADDR A:0xa4234
y.create.l HWIO_QFPROM_CORR_CALIB_ROW6_LSB_ADDR A:0xa4238
y.create.l HWIO_QFPROM_CORR_CALIB_ROW6_MSB_ADDR A:0xa423c
y.create.l HWIO_QFPROM_CORR_CALIB_ROW7_LSB_ADDR A:0xa4240
y.create.l HWIO_QFPROM_CORR_CALIB_ROW7_MSB_ADDR A:0xa4244
y.create.l HWIO_QFPROM_CORR_CALIB_ROW8_LSB_ADDR A:0xa4248
y.create.l HWIO_QFPROM_CORR_CALIB_ROW8_MSB_ADDR A:0xa424c
y.create.l HWIO_QFPROM_CORR_CALIB_ROW9_LSB_ADDR A:0xa4250
y.create.l HWIO_QFPROM_CORR_CALIB_ROW9_MSB_ADDR A:0xa4254
y.create.l HWIO_QFPROM_CORR_MEM_CONFIG_ROW0_LSB_ADDR A:0xa4258
y.create.l HWIO_QFPROM_CORR_MEM_CONFIG_ROW1_LSB_ADDR A:0xa4260
y.create.l HWIO_QFPROM_CORR_MEM_CONFIG_ROW2_LSB_ADDR A:0xa4268
y.create.l HWIO_QFPROM_CORR_MEM_CONFIG_ROW3_LSB_ADDR A:0xa4270
y.create.l HWIO_QFPROM_CORR_MEM_CONFIG_ROW4_LSB_ADDR A:0xa4278
y.create.l HWIO_QFPROM_CORR_MEM_CONFIG_ROW5_LSB_ADDR A:0xa4280
y.create.l HWIO_QFPROM_CORR_MEM_CONFIG_ROW6_LSB_ADDR A:0xa4288
y.create.l HWIO_QFPROM_CORR_MEM_CONFIG_ROW7_LSB_ADDR A:0xa4290
y.create.l HWIO_QFPROM_CORR_MEM_CONFIG_ROW8_LSB_ADDR A:0xa4298
y.create.l HWIO_QFPROM_CORR_MEM_CONFIG_ROW0_MSB_ADDR A:0xa425c
y.create.l HWIO_QFPROM_CORR_MEM_CONFIG_ROW1_MSB_ADDR A:0xa4264
y.create.l HWIO_QFPROM_CORR_MEM_CONFIG_ROW2_MSB_ADDR A:0xa426c
y.create.l HWIO_QFPROM_CORR_MEM_CONFIG_ROW3_MSB_ADDR A:0xa4274
y.create.l HWIO_QFPROM_CORR_MEM_CONFIG_ROW4_MSB_ADDR A:0xa427c
y.create.l HWIO_QFPROM_CORR_MEM_CONFIG_ROW5_MSB_ADDR A:0xa4284
y.create.l HWIO_QFPROM_CORR_MEM_CONFIG_ROW6_MSB_ADDR A:0xa428c
y.create.l HWIO_QFPROM_CORR_MEM_CONFIG_ROW7_MSB_ADDR A:0xa4294
y.create.l HWIO_QFPROM_CORR_MEM_CONFIG_ROW8_MSB_ADDR A:0xa429c
y.create.l HWIO_QFPROM_CORR_MEM_CONFIG_ROW9_LSB_ADDR A:0xa42a0
y.create.l HWIO_QFPROM_CORR_MEM_CONFIG_ROW9_MSB_ADDR A:0xa42a4
y.create.l HWIO_QFPROM_CORR_MEM_CONFIG_ROW10_LSB_ADDR A:0xa42a8
y.create.l HWIO_QFPROM_CORR_MEM_CONFIG_ROW10_MSB_ADDR A:0xa42ac
y.create.l HWIO_QFPROM_CORR_ROM_PATCH_ROW0_LSB_ADDR A:0xa42b0
y.create.l HWIO_QFPROM_CORR_ROM_PATCH_ROW1_LSB_ADDR A:0xa42b8
y.create.l HWIO_QFPROM_CORR_ROM_PATCH_ROW2_LSB_ADDR A:0xa42c0
y.create.l HWIO_QFPROM_CORR_ROM_PATCH_ROW3_LSB_ADDR A:0xa42c8
y.create.l HWIO_QFPROM_CORR_ROM_PATCH_ROW4_LSB_ADDR A:0xa42d0
y.create.l HWIO_QFPROM_CORR_ROM_PATCH_ROW5_LSB_ADDR A:0xa42d8
y.create.l HWIO_QFPROM_CORR_ROM_PATCH_ROW6_LSB_ADDR A:0xa42e0
y.create.l HWIO_QFPROM_CORR_ROM_PATCH_ROW7_LSB_ADDR A:0xa42e8
y.create.l HWIO_QFPROM_CORR_ROM_PATCH_ROW8_LSB_ADDR A:0xa42f0
y.create.l HWIO_QFPROM_CORR_ROM_PATCH_ROW9_LSB_ADDR A:0xa42f8
y.create.l HWIO_QFPROM_CORR_ROM_PATCH_ROW0_MSB_ADDR A:0xa42b4
y.create.l HWIO_QFPROM_CORR_ROM_PATCH_ROW1_MSB_ADDR A:0xa42bc
y.create.l HWIO_QFPROM_CORR_ROM_PATCH_ROW2_MSB_ADDR A:0xa42c4
y.create.l HWIO_QFPROM_CORR_ROM_PATCH_ROW3_MSB_ADDR A:0xa42cc
y.create.l HWIO_QFPROM_CORR_ROM_PATCH_ROW4_MSB_ADDR A:0xa42d4
y.create.l HWIO_QFPROM_CORR_ROM_PATCH_ROW5_MSB_ADDR A:0xa42dc
y.create.l HWIO_QFPROM_CORR_ROM_PATCH_ROW6_MSB_ADDR A:0xa42e4
y.create.l HWIO_QFPROM_CORR_ROM_PATCH_ROW7_MSB_ADDR A:0xa42ec
y.create.l HWIO_QFPROM_CORR_ROM_PATCH_ROW8_MSB_ADDR A:0xa42f4
y.create.l HWIO_QFPROM_CORR_ROM_PATCH_ROW9_MSB_ADDR A:0xa42fc
y.create.l HWIO_QFPROM_CORR_FEC_EN_LSB_ADDR A:0xa43b0
y.create.l HWIO_QFPROM_CORR_FEC_EN_MSB_ADDR A:0xa43b4
y.create.l HWIO_QFPROM_CORR_SPARE_REG18_LSB_ADDR A:0xa43b8
y.create.l HWIO_QFPROM_CORR_SPARE_REG18_MSB_ADDR A:0xa43bc
y.create.l HWIO_QFPROM_CORR_SPARE_REG19_LSB_ADDR A:0xa43c0
y.create.l HWIO_QFPROM_CORR_SPARE_REG19_MSB_ADDR A:0xa43c4
y.create.l HWIO_QFPROM_CORR_SPARE_REG20_LSB_ADDR A:0xa43c8
y.create.l HWIO_QFPROM_CORR_SPARE_REG20_MSB_ADDR A:0xa43cc
y.create.l HWIO_QFPROM_CORR_SPARE_REG21_LSB_ADDR A:0xa43d0
y.create.l HWIO_QFPROM_CORR_SPARE_REG21_MSB_ADDR A:0xa43d4
y.create.l HWIO_QFPROM_CORR_SPARE_REG22_LSB_ADDR A:0xa43d8
y.create.l HWIO_QFPROM_CORR_SPARE_REG22_MSB_ADDR A:0xa43dc
y.create.l HWIO_QFPROM_CORR_SPARE_REG23_LSB_ADDR A:0xa43e0
y.create.l HWIO_QFPROM_CORR_SPARE_REG23_MSB_ADDR A:0xa43e4
y.create.l HWIO_QFPROM_CORR_SPARE_REG24_LSB_ADDR A:0xa43e8
y.create.l HWIO_QFPROM_CORR_SPARE_REG24_MSB_ADDR A:0xa43ec
y.create.l HWIO_QFPROM_CORR_SPARE_REG25_LSB_ADDR A:0xa43f0
y.create.l HWIO_QFPROM_CORR_SPARE_REG25_MSB_ADDR A:0xa43f4
y.create.l HWIO_QFPROM_CORR_SPARE_REG26_LSB_ADDR A:0xa43f8
y.create.l HWIO_QFPROM_CORR_SPARE_REG26_MSB_ADDR A:0xa43fc
y.create.l HWIO_QFPROM_CORR_ACC_PRIVATE0_ADDR A:0xa4800
y.create.l HWIO_QFPROM_CORR_ACC_PRIVATE1_ADDR A:0xa4804
y.create.l HWIO_QFPROM_CORR_ACC_PRIVATE2_ADDR A:0xa4808
y.create.l HWIO_QFPROM_CORR_ACC_PRIVATE3_ADDR A:0xa480c
y.create.l HWIO_QFPROM_CORR_ACC_PRIVATE4_ADDR A:0xa4810
y.create.l HWIO_QFPROM_CORR_ACC_PRIVATE5_ADDR A:0xa4814
y.create.l HWIO_QFPROM_CORR_ACC_PRIVATE6_ADDR A:0xa4818
y.create.l HWIO_QFPROM_CORR_ACC_PRIVATE7_ADDR A:0xa481c
y.create.l HWIO_QFPROM_CORR_ACC_PRIVATE8_ADDR A:0xa4820
y.create.l HWIO_QFPROM_CORR_ACC_PRIVATE9_ADDR A:0xa4824
y.create.l HWIO_SEC_CTRL_HW_VERSION_ADDR A:0xa6000
y.create.l HWIO_FEATURE_CONFIG0_ADDR A:0xa6004
y.create.l HWIO_FEATURE_CONFIG1_ADDR A:0xa6008
y.create.l HWIO_FEATURE_CONFIG2_ADDR A:0xa600c
y.create.l HWIO_FEATURE_CONFIG3_ADDR A:0xa6010
y.create.l HWIO_FEATURE_CONFIG4_ADDR A:0xa6014
y.create.l HWIO_FEATURE_CONFIG5_ADDR A:0xa6018
y.create.l HWIO_OEM_CONFIG0_ADDR A:0xa601c
y.create.l HWIO_OEM_CONFIG1_ADDR A:0xa6020
y.create.l HWIO_OEM_CONFIG2_ADDR A:0xa6024
y.create.l HWIO_OEM_CONFIG3_ADDR A:0xa6028
y.create.l HWIO_BOOT_CONFIG_ADDR A:0xa602c
y.create.l HWIO_SECURE_BOOT1_ADDR A:0xa6034
y.create.l HWIO_SECURE_BOOT2_ADDR A:0xa6038
y.create.l HWIO_SECURE_BOOT3_ADDR A:0xa603c
y.create.l HWIO_SECURE_BOOT4_ADDR A:0xa6040
y.create.l HWIO_SECURE_BOOT5_ADDR A:0xa6044
y.create.l HWIO_SECURE_BOOT6_ADDR A:0xa6048
y.create.l HWIO_SECURE_BOOT7_ADDR A:0xa604c
y.create.l HWIO_OVERRIDE_0_ADDR A:0xa6058
y.create.l HWIO_OVERRIDE_1_ADDR A:0xa605c
y.create.l HWIO_OVERRIDE_2_ADDR A:0xa6060
y.create.l HWIO_OVERRIDE_3_ADDR A:0xa6064
y.create.l HWIO_OVERRIDE_4_ADDR A:0xa6068
y.create.l HWIO_CAPT_SEC_GPIO_ADDR A:0xa606c
y.create.l HWIO_APP_PROC_CFG_ADDR A:0xa6070
y.create.l HWIO_MSS_PROC_CFG_ADDR A:0xa6074
y.create.l HWIO_QFPROM_CLK_CTL_ADDR A:0xa6078
y.create.l HWIO_JTAG_ID_ADDR A:0xa607c
y.create.l HWIO_OEM_ID_ADDR A:0xa6080
y.create.l HWIO_TEST_BUS_SEL_ADDR A:0xa6084
y.create.l HWIO_SPDM_DYN_SECURE_MODE_ADDR A:0xa6088
y.create.l HWIO_OVERRIDE_5_ADDR A:0xa608c
y.create.l HWIO_OVERRIDE_6_ADDR A:0xa6090
y.create.l HWIO_PTE0_ADDR A:0xa60a0
y.create.l HWIO_PTE1_ADDR A:0xa60a4
y.create.l HWIO_SERIAL_NUM_ADDR A:0xa60a8
y.create.l HWIO_PTE2_ADDR A:0xa60ac
y.create.l HWIO_ANTI_ROLLBACK_1_0_ADDR A:0xa60b0
y.create.l HWIO_ANTI_ROLLBACK_1_1_ADDR A:0xa60b4
y.create.l HWIO_ANTI_ROLLBACK_2_0_ADDR A:0xa60b8
y.create.l HWIO_ANTI_ROLLBACK_2_1_ADDR A:0xa60bc
y.create.l HWIO_ANTI_ROLLBACK_3_0_ADDR A:0xa60c0
y.create.l HWIO_ANTI_ROLLBACK_3_1_ADDR A:0xa60c4
y.create.l HWIO_PK_HASH_0_ADDR A:0xa60c8
y.create.l HWIO_PK_HASH_1_ADDR A:0xa60cc
y.create.l HWIO_PK_HASH_2_ADDR A:0xa60d0
y.create.l HWIO_PK_HASH_3_ADDR A:0xa60d4
y.create.l HWIO_PK_HASH_4_ADDR A:0xa60d8
y.create.l HWIO_PK_HASH_5_ADDR A:0xa60dc
y.create.l HWIO_PK_HASH_6_ADDR A:0xa60e0
y.create.l HWIO_PK_HASH_7_ADDR A:0xa60e4
y.create.l HWIO_QFPROM_WRITE_DISABLE_STICKY_BIT0_ADDR A:0xa6100
y.create.l HWIO_QFPROM_WRITE_DISABLE_STICKY_BIT1_ADDR A:0xa6104
y.create.l HWIO_KEY_CTRL_VERSION_ADDR A:0xab000
y.create.l HWIO_KEY_CTRL_HW_PARAMS_ADDR A:0xab004
y.create.l HWIO_KEY_CTRL_STATUS_ADDR A:0xab00c
y.create.l HWIO_KEY_CTRL_CACHE0INFO_IDX0_ADDR A:0xab010
y.create.l HWIO_KEY_CTRL_CACHE1INFO_IDX0_ADDR A:0xab020
y.create.l HWIO_KEY_CTRL_CACHE2INFO_IDX0_ADDR A:0xab030
y.create.l HWIO_KEY_CTRL_CACHE3INFO_IDX0_ADDR A:0xab040
y.create.l HWIO_KEY_CTRL_CACHE0INFO_IDX1_ADDR A:0xab014
y.create.l HWIO_KEY_CTRL_CACHE1INFO_IDX1_ADDR A:0xab024
y.create.l HWIO_KEY_CTRL_CACHE2INFO_IDX1_ADDR A:0xab034
y.create.l HWIO_KEY_CTRL_CACHE3INFO_IDX1_ADDR A:0xab044
y.create.l HWIO_KEY_CTRL_DEBUG_ENABLE_ADDR A:0xab100
y.create.l HWIO_KEY_CTRL_DEBUG_BUS_ADDR A:0xab104
y.create.l HWIO_KEY_CTRL_CACHE0INFO_IDX2_ADDR A:0xab018
y.create.l HWIO_KEY_CTRL_CACHE1INFO_IDX2_ADDR A:0xab028
y.create.l HWIO_KEY_CTRL_CACHE2INFO_IDX2_ADDR A:0xab038
y.create.l HWIO_KEY_CTRL_CACHE3INFO_IDX2_ADDR A:0xab048
y.create.l HWIO_KEY_CTRL_EE0_COMMAND_ADDR A:0xa8100
y.create.l HWIO_KEY_CTRL_EE1_COMMAND_ADDR A:0xa9100
y.create.l HWIO_KEY_CTRL_EE2_COMMAND_ADDR A:0xaa100
y.create.l HWIO_KEY_CTRL_EE0KEY_INFO_ADDR A:0xa8104
y.create.l HWIO_KEY_CTRL_EE1KEY_INFO_ADDR A:0xa9104
y.create.l HWIO_KEY_CTRL_EE2KEY_INFO_ADDR A:0xaa104
y.create.l HWIO_KEY_CTRL_EE0KEY_IDX0_ADDR A:0xa8200
y.create.l HWIO_KEY_CTRL_EE0KEY_IDX1_ADDR A:0xa8204
y.create.l HWIO_KEY_CTRL_EE0KEY_IDX2_ADDR A:0xa8208
y.create.l HWIO_KEY_CTRL_EE0KEY_IDX3_ADDR A:0xa820c
y.create.l HWIO_KEY_CTRL_EE1KEY_IDX0_ADDR A:0xa9200
y.create.l HWIO_KEY_CTRL_EE1KEY_IDX1_ADDR A:0xa9204
y.create.l HWIO_KEY_CTRL_EE1KEY_IDX2_ADDR A:0xa9208
y.create.l HWIO_KEY_CTRL_EE1KEY_IDX3_ADDR A:0xa920c
y.create.l HWIO_KEY_CTRL_EE2KEY_IDX0_ADDR A:0xaa200
y.create.l HWIO_KEY_CTRL_EE2KEY_IDX1_ADDR A:0xaa204
y.create.l HWIO_KEY_CTRL_EE2KEY_IDX2_ADDR A:0xaa208
y.create.l HWIO_KEY_CTRL_EE2KEY_IDX3_ADDR A:0xaa20c
y.create.l HWIO_CRI_CM_CHIP_SERIES_ADDR A:0xac000
y.create.l HWIO_CRI_CM_VERSION_ADDR A:0xac004
y.create.l HWIO_CRI_CM_DEVICE_ID_0_ADDR A:0xac0f0
y.create.l HWIO_CRI_CM_DEVICE_ID_1_ADDR A:0xac0f4
y.create.l HWIO_CRI_CM_PADAK_ID_0_ADDR A:0xac0f8
y.create.l HWIO_CRI_CM_PADAK_ID_1_ADDR A:0xac0fc
y.create.l HWIO_CRI_CM_CONFIG_0_ADDR A:0xac0e0
y.create.l HWIO_CRI_CM_CONFIG_1_ADDR A:0xac0e4
y.create.l HWIO_CRI_CM_CONFIG_2_ADDR A:0xac0e8
y.create.l HWIO_CRI_CM_CONFIG_3_ADDR A:0xac0ec
y.create.l HWIO_CRI_CM_STATUS_SUMMARY_ADDR A:0xac008
y.create.l HWIO_CRI_CM_STATUS_FLAGS_ADDR A:0xac00c
y.create.l HWIO_CRI_CM_STATUS_REGWRITE_COUNT_ADDR A:0xac010
y.create.l HWIO_CRI_CM_STATUS_KEYS_ADDR A:0xac014
y.create.l HWIO_CRI_CM_STATUS_KEYS_2_ADDR A:0xac038
y.create.l HWIO_CRI_CM_ERROR_SEQ_ADDR A:0xac034
y.create.l HWIO_CRI_CM_ERROR_INFO_ADDR A:0xac018
y.create.l HWIO_CRI_CM_ERROR_OTP_ADDR A:0xac01c
y.create.l HWIO_CRI_CM_INIT_ERROR_ADDR_ADDR A:0xac060
y.create.l HWIO_CRI_CM_INIT_ERROR_INFO_ADDR A:0xac064
y.create.l HWIO_CRI_CM_INIT_ERROR_OTP_ADDR A:0xac068
y.create.l HWIO_CRI_CM_OTPCMD_ERROR_ADDR_ADDR A:0xac070
y.create.l HWIO_CRI_CM_OTPCMD_ERROR_INFO_ADDR A:0xac074
y.create.l HWIO_CRI_CM_OTPCMD_ERROR_OTP_ADDR A:0xac078
y.create.l HWIO_CRI_CM_TRNG_ERROR_ADDR A:0xac03c
y.create.l HWIO_CRI_CM_TRNG_CTRL_1_ADDR A:0xac0d0
y.create.l HWIO_CRI_CM_TRNG_CTRL_2_ADDR A:0xac0d4
y.create.l HWIO_CRI_CM_IRQ_CONTROL_ADDR A:0xac020
y.create.l HWIO_CRI_CM_IRQ_STATUS_ADDR A:0xac024
y.create.l HWIO_CRI_CM_CONTROL_ADDR A:0xac028
y.create.l HWIO_CRI_CM_SEQUENCE_INPUT_ADDR A:0xac02c
y.create.l HWIO_CRI_CM_SEQUENCE_OUTPUT_ADDR A:0xac030
y.create.l HWIO_CRI_CM_SW_BUFFER_0_ADDR A:0xac080
y.create.l HWIO_CRI_CM_SW_BUFFER_1_ADDR A:0xac084
y.create.l HWIO_CRI_CM_SW_BUFFER_2_ADDR A:0xac088
y.create.l HWIO_CRI_CM_SW_BUFFER_3_ADDR A:0xac08c
y.create.l HWIO_CRI_CM_SW_BUFFER_4_ADDR A:0xac090
y.create.l HWIO_CRI_CM_SW_BUFFER_5_ADDR A:0xac094
y.create.l HWIO_CRI_CM_SW_BUFFER_6_ADDR A:0xac098
y.create.l HWIO_CRI_CM_SW_BUFFER_7_ADDR A:0xac09c
y.create.l HWIO_CRI_CM_SW_BUFFER_8_ADDR A:0xac0a0
y.create.l HWIO_CRI_CM_SW_BUFFER_9_ADDR A:0xac0a4
y.create.l HWIO_CRI_CM_DIRECTREAD_FEATURE_REQ_ADDR A:0xac040
y.create.l HWIO_CRI_CM_DIRECTREAD_FEATURE_STATUS_ADDR A:0xac044
y.create.l HWIO_CRI_CM_DIRECTREAD_FEATURE_DATA_ADDR A:0xac048
y.create.l HWIO_CRI_CM_DIRECTREAD_OTP_REQ_ADDR A:0xac050
y.create.l HWIO_CRI_CM_DIRECTREAD_OTP_STATUS_ADDR A:0xac054
y.create.l HWIO_CRI_CM_DIRECTREAD_OTP_DATA_ADDR A:0xac058
y.create.l HWIO_CRI_CM_DEVICE_ID_STATUS_ADDR A:0xac100
y.create.l HWIO_CRI_CM_CHIP_ID_ADDR A:0xac10c
y.create.l HWIO_CRI_CM_CHIP_SERIAL_NUM_ADDR A:0xac110
y.create.l HWIO_CRI_CM_OEM_ID_ADDR A:0xac114
y.create.l HWIO_CRI_CM_BIST_CTRL_0_ADDR A:0xac120
y.create.l HWIO_CRI_CM_TRNG_CTRL_0_ADDR A:0xac124
y.create.l HWIO_SEC_CTRL_XPU_XPU_SCR_ADDR A:0xae000
y.create.l HWIO_SEC_CTRL_XPU_XPU_SWDR_ADDR A:0xae004
y.create.l HWIO_SEC_CTRL_XPU_XPU_SEAR0_ADDR A:0xae040
y.create.l HWIO_SEC_CTRL_XPU_XPU_SESR_ADDR A:0xae048
y.create.l HWIO_SEC_CTRL_XPU_XPU_SESRRESTORE_ADDR A:0xae04c
y.create.l HWIO_SEC_CTRL_XPU_XPU_SESYNR0_ADDR A:0xae050
y.create.l HWIO_SEC_CTRL_XPU_XPU_SESYNR1_ADDR A:0xae054
y.create.l HWIO_SEC_CTRL_XPU_XPU_SESYNR2_ADDR A:0xae058
y.create.l HWIO_SEC_CTRL_XPU_XPU_MCR_ADDR A:0xae100
y.create.l HWIO_SEC_CTRL_XPU_XPU_MEAR0_ADDR A:0xae140
y.create.l HWIO_SEC_CTRL_XPU_XPU_MESR_ADDR A:0xae148
y.create.l HWIO_SEC_CTRL_XPU_XPU_MESRRESTORE_ADDR A:0xae14c
y.create.l HWIO_SEC_CTRL_XPU_XPU_MESYNR0_ADDR A:0xae150
y.create.l HWIO_SEC_CTRL_XPU_XPU_MESYNR1_ADDR A:0xae154
y.create.l HWIO_SEC_CTRL_XPU_XPU_MESYNR2_ADDR A:0xae158
y.create.l HWIO_SEC_CTRL_XPU_XPU_CR_ADDR A:0xae080
y.create.l HWIO_SEC_CTRL_XPU_XPU_RPU_ACR0_ADDR A:0xae0a0
y.create.l HWIO_SEC_CTRL_XPU_XPU_EAR0_ADDR A:0xae0c0
y.create.l HWIO_SEC_CTRL_XPU_XPU_ESR_ADDR A:0xae0c8
y.create.l HWIO_SEC_CTRL_XPU_XPU_ESRRESTORE_ADDR A:0xae0cc
y.create.l HWIO_SEC_CTRL_XPU_XPU_ESYNR0_ADDR A:0xae0d0
y.create.l HWIO_SEC_CTRL_XPU_XPU_ESYNR1_ADDR A:0xae0d4
y.create.l HWIO_SEC_CTRL_XPU_XPU_ESYNR2_ADDR A:0xae0d8
y.create.l HWIO_SEC_CTRL_XPU_XPU_IDR0_ADDR A:0xae074
y.create.l HWIO_SEC_CTRL_XPU_XPU_IDR1_ADDR A:0xae078
y.create.l HWIO_SEC_CTRL_XPU_XPU_REV_ADDR A:0xae07c
y.create.l HWIO_SEC_CTRL_XPU_XPU_RG0_RACR0_ADDR A:0xae200
y.create.l HWIO_SEC_CTRL_XPU_XPU_RG1_RACR0_ADDR A:0xae280
y.create.l HWIO_SEC_CTRL_XPU_XPU_RG2_RACR0_ADDR A:0xae300
y.create.l HWIO_SEC_CTRL_XPU_XPU_RG3_RACR0_ADDR A:0xae380
y.create.l HWIO_SEC_CTRL_XPU_XPU_RG4_RACR0_ADDR A:0xae400
y.create.l HWIO_SEC_CTRL_XPU_XPU_RG5_RACR0_ADDR A:0xae480
y.create.l HWIO_SEC_CTRL_XPU_XPU_RG6_RACR0_ADDR A:0xae500
y.create.l HWIO_SEC_CTRL_XPU_XPU_RG7_RACR0_ADDR A:0xae580
y.create.l HWIO_SEC_CTRL_XPU_XPU_RG8_RACR0_ADDR A:0xae600
y.create.l HWIO_SEC_CTRL_XPU_XPU_RG9_RACR0_ADDR A:0xae680
y.create.l HWIO_SEC_CTRL_XPU_XPU_RG0_WACR0_ADDR A:0xae220
y.create.l HWIO_SEC_CTRL_XPU_XPU_RG1_WACR0_ADDR A:0xae2a0
y.create.l HWIO_SEC_CTRL_XPU_XPU_RG2_WACR0_ADDR A:0xae320
y.create.l HWIO_SEC_CTRL_XPU_XPU_RG3_WACR0_ADDR A:0xae3a0
y.create.l HWIO_SEC_CTRL_XPU_XPU_RG4_WACR0_ADDR A:0xae420
y.create.l HWIO_SEC_CTRL_XPU_XPU_RG5_WACR0_ADDR A:0xae4a0
y.create.l HWIO_SEC_CTRL_XPU_XPU_RG6_WACR0_ADDR A:0xae520
y.create.l HWIO_SEC_CTRL_XPU_XPU_RG7_WACR0_ADDR A:0xae5a0
y.create.l HWIO_SEC_CTRL_XPU_XPU_RG8_WACR0_ADDR A:0xae620
y.create.l HWIO_SEC_CTRL_XPU_XPU_RG9_WACR0_ADDR A:0xae6a0
y.create.l HWIO_SEC_CTRL_XPU_XPU_RG0_SCR_ADDR A:0xae250
y.create.l HWIO_SEC_CTRL_XPU_XPU_RG1_SCR_ADDR A:0xae2d0
y.create.l HWIO_SEC_CTRL_XPU_XPU_RG2_SCR_ADDR A:0xae350
y.create.l HWIO_SEC_CTRL_XPU_XPU_RG3_SCR_ADDR A:0xae3d0
y.create.l HWIO_SEC_CTRL_XPU_XPU_RG4_SCR_ADDR A:0xae450
y.create.l HWIO_SEC_CTRL_XPU_XPU_RG5_SCR_ADDR A:0xae4d0
y.create.l HWIO_SEC_CTRL_XPU_XPU_RG6_SCR_ADDR A:0xae550
y.create.l HWIO_SEC_CTRL_XPU_XPU_RG7_SCR_ADDR A:0xae5d0
y.create.l HWIO_SEC_CTRL_XPU_XPU_RG8_SCR_ADDR A:0xae650
y.create.l HWIO_SEC_CTRL_XPU_XPU_RG9_SCR_ADDR A:0xae6d0
y.create.l HWIO_SEC_CTRL_XPU_XPU_RG0_MCR_ADDR A:0xae254
y.create.l HWIO_SEC_CTRL_XPU_XPU_RG1_MCR_ADDR A:0xae2d4
y.create.l HWIO_SEC_CTRL_XPU_XPU_RG2_MCR_ADDR A:0xae354
y.create.l HWIO_SEC_CTRL_XPU_XPU_RG3_MCR_ADDR A:0xae3d4
y.create.l HWIO_SEC_CTRL_XPU_XPU_RG4_MCR_ADDR A:0xae454
y.create.l HWIO_SEC_CTRL_XPU_XPU_RG5_MCR_ADDR A:0xae4d4
y.create.l HWIO_SEC_CTRL_XPU_XPU_RG6_MCR_ADDR A:0xae554
y.create.l HWIO_SEC_CTRL_XPU_XPU_RG7_MCR_ADDR A:0xae5d4
y.create.l HWIO_SEC_CTRL_XPU_XPU_RG8_MCR_ADDR A:0xae654
y.create.l HWIO_SEC_CTRL_XPU_XPU_RG9_MCR_ADDR A:0xae6d4
y.create.l HWIO_TCU_XPU_SCR_TCU_ADDR A:0x34000
y.create.l HWIO_TCU_XPU_SWDR_TCU_ADDR A:0x34004
y.create.l HWIO_TCU_XPU_PRTN_RACR_SSHADOW_TCU_ADDR A:0x34008
y.create.l HWIO_TCU_XPU_PRTN_WACR_SSHADOW_TCU_ADDR A:0x3400c
y.create.l HWIO_TCU_XPU_PRTN_START_SSHADOW0_TCU_ADDR A:0x34010
y.create.l HWIO_TCU_XPU_PRTN_END_SSHADOW0_TCU_ADDR A:0x34018
y.create.l HWIO_TCU_XPU_SEAR0_TCU_ADDR A:0x34040
y.create.l HWIO_TCU_XPU_SESR_TCU_ADDR A:0x34048
y.create.l HWIO_TCU_XPU_SESRRESTORE_TCU_ADDR A:0x3404c
y.create.l HWIO_TCU_XPU_SESYNR0_TCU_ADDR A:0x34050
y.create.l HWIO_TCU_XPU_SESYNR1_TCU_ADDR A:0x34054
y.create.l HWIO_TCU_XPU_SESYNR2_TCU_ADDR A:0x34058
y.create.l HWIO_TCU_XPU_MCR_TCU_ADDR A:0x34100
y.create.l HWIO_TCU_XPU_MEAR0_TCU_ADDR A:0x34140
y.create.l HWIO_TCU_XPU_MESR_TCU_ADDR A:0x34148
y.create.l HWIO_TCU_XPU_MESRRESTORE_TCU_ADDR A:0x3414c
y.create.l HWIO_TCU_XPU_MESYNR0_TCU_ADDR A:0x34150
y.create.l HWIO_TCU_XPU_MESYNR1_TCU_ADDR A:0x34154
y.create.l HWIO_TCU_XPU_MESYNR2_TCU_ADDR A:0x34158
y.create.l HWIO_TCU_XPU_CR_TCU_ADDR A:0x34080
y.create.l HWIO_TCU_XPU_PRTN_RACR_SHADOW_TCU_ADDR A:0x34088
y.create.l HWIO_TCU_XPU_PRTN_WACR_SHADOW_TCU_ADDR A:0x3408c
y.create.l HWIO_TCU_XPU_PRTN_START_SHADOW0_TCU_ADDR A:0x34090
y.create.l HWIO_TCU_XPU_PRTN_END_SHADOW0_TCU_ADDR A:0x34098
y.create.l HWIO_TCU_XPU_RPU_ACR0_TCU_ADDR A:0x340a0
y.create.l HWIO_TCU_XPU_EAR0_TCU_ADDR A:0x340c0
y.create.l HWIO_TCU_XPU_ESR_TCU_ADDR A:0x340c8
y.create.l HWIO_TCU_XPU_ESRRESTORE_TCU_ADDR A:0x340cc
y.create.l HWIO_TCU_XPU_ESYNR0_TCU_ADDR A:0x340d0
y.create.l HWIO_TCU_XPU_ESYNR1_TCU_ADDR A:0x340d4
y.create.l HWIO_TCU_XPU_ESYNR2_TCU_ADDR A:0x340d8
y.create.l HWIO_TCU_XPU_UMR_RACR_TCU_ADDR A:0x340e0
y.create.l HWIO_TCU_XPU_UMR_WACR_TCU_ADDR A:0x340e4
y.create.l HWIO_TCU_XPU_UMR_CNTL_TCU_ADDR A:0x340f0
y.create.l HWIO_TCU_XPU_IDR0_TCU_ADDR A:0x34074
y.create.l HWIO_TCU_XPU_IDR1_TCU_ADDR A:0x34078
y.create.l HWIO_TCU_XPU_REV_TCU_ADDR A:0x3407c
y.create.l HWIO_TCU_XPU_PRT0_RACR0_TCU_ADDR A:0x34200
y.create.l HWIO_TCU_XPU_PRT1_RACR0_TCU_ADDR A:0x34280
y.create.l HWIO_TCU_XPU_PRT2_RACR0_TCU_ADDR A:0x34300
y.create.l HWIO_TCU_XPU_PRT3_RACR0_TCU_ADDR A:0x34380
y.create.l HWIO_TCU_XPU_PRT4_RACR0_TCU_ADDR A:0x34400
y.create.l HWIO_TCU_XPU_PRT5_RACR0_TCU_ADDR A:0x34480
y.create.l HWIO_TCU_XPU_PRT6_RACR0_TCU_ADDR A:0x34500
y.create.l HWIO_TCU_XPU_PRT7_RACR0_TCU_ADDR A:0x34580
y.create.l HWIO_TCU_XPU_PRT8_RACR0_TCU_ADDR A:0x34600
y.create.l HWIO_TCU_XPU_PRT9_RACR0_TCU_ADDR A:0x34680
y.create.l HWIO_TCU_XPU_PRT0_WACR0_TCU_ADDR A:0x34220
y.create.l HWIO_TCU_XPU_PRT1_WACR0_TCU_ADDR A:0x342a0
y.create.l HWIO_TCU_XPU_PRT2_WACR0_TCU_ADDR A:0x34320
y.create.l HWIO_TCU_XPU_PRT3_WACR0_TCU_ADDR A:0x343a0
y.create.l HWIO_TCU_XPU_PRT4_WACR0_TCU_ADDR A:0x34420
y.create.l HWIO_TCU_XPU_PRT5_WACR0_TCU_ADDR A:0x344a0
y.create.l HWIO_TCU_XPU_PRT6_WACR0_TCU_ADDR A:0x34520
y.create.l HWIO_TCU_XPU_PRT7_WACR0_TCU_ADDR A:0x345a0
y.create.l HWIO_TCU_XPU_PRT8_WACR0_TCU_ADDR A:0x34620
y.create.l HWIO_TCU_XPU_PRT9_WACR0_TCU_ADDR A:0x346a0
y.create.l HWIO_TCU_XPU_PRT0_START0_TCU_ADDR A:0x34240
y.create.l HWIO_TCU_XPU_PRT1_START0_TCU_ADDR A:0x342c0
y.create.l HWIO_TCU_XPU_PRT2_START0_TCU_ADDR A:0x34340
y.create.l HWIO_TCU_XPU_PRT3_START0_TCU_ADDR A:0x343c0
y.create.l HWIO_TCU_XPU_PRT4_START0_TCU_ADDR A:0x34440
y.create.l HWIO_TCU_XPU_PRT5_START0_TCU_ADDR A:0x344c0
y.create.l HWIO_TCU_XPU_PRT6_START0_TCU_ADDR A:0x34540
y.create.l HWIO_TCU_XPU_PRT7_START0_TCU_ADDR A:0x345c0
y.create.l HWIO_TCU_XPU_PRT8_START0_TCU_ADDR A:0x34640
y.create.l HWIO_TCU_XPU_PRT9_START0_TCU_ADDR A:0x346c0
y.create.l HWIO_TCU_XPU_PRT0_END0_TCU_ADDR A:0x34248
y.create.l HWIO_TCU_XPU_PRT1_END0_TCU_ADDR A:0x342c8
y.create.l HWIO_TCU_XPU_PRT2_END0_TCU_ADDR A:0x34348
y.create.l HWIO_TCU_XPU_PRT3_END0_TCU_ADDR A:0x343c8
y.create.l HWIO_TCU_XPU_PRT4_END0_TCU_ADDR A:0x34448
y.create.l HWIO_TCU_XPU_PRT5_END0_TCU_ADDR A:0x344c8
y.create.l HWIO_TCU_XPU_PRT6_END0_TCU_ADDR A:0x34548
y.create.l HWIO_TCU_XPU_PRT7_END0_TCU_ADDR A:0x345c8
y.create.l HWIO_TCU_XPU_PRT8_END0_TCU_ADDR A:0x34648
y.create.l HWIO_TCU_XPU_PRT9_END0_TCU_ADDR A:0x346c8
y.create.l HWIO_TCU_XPU_PRT0_SCR_TCU_ADDR A:0x34250
y.create.l HWIO_TCU_XPU_PRT1_SCR_TCU_ADDR A:0x342d0
y.create.l HWIO_TCU_XPU_PRT2_SCR_TCU_ADDR A:0x34350
y.create.l HWIO_TCU_XPU_PRT3_SCR_TCU_ADDR A:0x343d0
y.create.l HWIO_TCU_XPU_PRT4_SCR_TCU_ADDR A:0x34450
y.create.l HWIO_TCU_XPU_PRT5_SCR_TCU_ADDR A:0x344d0
y.create.l HWIO_TCU_XPU_PRT6_SCR_TCU_ADDR A:0x34550
y.create.l HWIO_TCU_XPU_PRT7_SCR_TCU_ADDR A:0x345d0
y.create.l HWIO_TCU_XPU_PRT8_SCR_TCU_ADDR A:0x34650
y.create.l HWIO_TCU_XPU_PRT9_SCR_TCU_ADDR A:0x346d0
y.create.l HWIO_TCU_XPU_PRT0_MCR_TCU_ADDR A:0x34254
y.create.l HWIO_TCU_XPU_PRT1_MCR_TCU_ADDR A:0x342d4
y.create.l HWIO_TCU_XPU_PRT2_MCR_TCU_ADDR A:0x34354
y.create.l HWIO_TCU_XPU_PRT3_MCR_TCU_ADDR A:0x343d4
y.create.l HWIO_TCU_XPU_PRT4_MCR_TCU_ADDR A:0x34454
y.create.l HWIO_TCU_XPU_PRT5_MCR_TCU_ADDR A:0x344d4
y.create.l HWIO_TCU_XPU_PRT6_MCR_TCU_ADDR A:0x34554
y.create.l HWIO_TCU_XPU_PRT7_MCR_TCU_ADDR A:0x345d4
y.create.l HWIO_TCU_XPU_PRT8_MCR_TCU_ADDR A:0x34654
y.create.l HWIO_TCU_XPU_PRT9_MCR_TCU_ADDR A:0x346d4
y.create.l HWIO_TCU_XPU_PRT0_CNTL0_TCU_ADDR A:0x34258
y.create.l HWIO_TCU_XPU_PRT1_CNTL0_TCU_ADDR A:0x342d8
y.create.l HWIO_TCU_XPU_PRT2_CNTL0_TCU_ADDR A:0x34358
y.create.l HWIO_TCU_XPU_PRT3_CNTL0_TCU_ADDR A:0x343d8
y.create.l HWIO_TCU_XPU_PRT4_CNTL0_TCU_ADDR A:0x34458
y.create.l HWIO_TCU_XPU_PRT5_CNTL0_TCU_ADDR A:0x344d8
y.create.l HWIO_TCU_XPU_PRT6_CNTL0_TCU_ADDR A:0x34558
y.create.l HWIO_TCU_XPU_PRT7_CNTL0_TCU_ADDR A:0x345d8
y.create.l HWIO_TCU_XPU_PRT8_CNTL0_TCU_ADDR A:0x34658
y.create.l HWIO_TCU_XPU_PRT9_CNTL0_TCU_ADDR A:0x346d8
y.create.l HWIO_TCU_XPU_PRT0_CNTL1_TCU_ADDR A:0x3425c
y.create.l HWIO_TCU_XPU_PRT1_CNTL1_TCU_ADDR A:0x342dc
y.create.l HWIO_TCU_XPU_PRT2_CNTL1_TCU_ADDR A:0x3435c
y.create.l HWIO_TCU_XPU_PRT3_CNTL1_TCU_ADDR A:0x343dc
y.create.l HWIO_TCU_XPU_PRT4_CNTL1_TCU_ADDR A:0x3445c
y.create.l HWIO_TCU_XPU_PRT5_CNTL1_TCU_ADDR A:0x344dc
y.create.l HWIO_TCU_XPU_PRT6_CNTL1_TCU_ADDR A:0x3455c
y.create.l HWIO_TCU_XPU_PRT7_CNTL1_TCU_ADDR A:0x345dc
y.create.l HWIO_TCU_XPU_PRT8_CNTL1_TCU_ADDR A:0x3465c
y.create.l HWIO_TCU_XPU_PRT9_CNTL1_TCU_ADDR A:0x346dc
y.create.l HWIO_MCDMA_XPU_SCR_MCDMA_ADDR A:0x35000
y.create.l HWIO_MCDMA_XPU_SWDR_MCDMA_ADDR A:0x35004
y.create.l HWIO_MCDMA_XPU_PRTN_RACR_SSHADOW_MCDMA_ADDR A:0x35008
y.create.l HWIO_MCDMA_XPU_PRTN_START_SSHADOW0_MCDMA_ADDR A:0x35010
y.create.l HWIO_MCDMA_XPU_PRTN_END_SSHADOW0_MCDMA_ADDR A:0x35018
y.create.l HWIO_MCDMA_XPU_SEAR0_MCDMA_ADDR A:0x35040
y.create.l HWIO_MCDMA_XPU_SESR_MCDMA_ADDR A:0x35048
y.create.l HWIO_MCDMA_XPU_SESRRESTORE_MCDMA_ADDR A:0x3504c
y.create.l HWIO_MCDMA_XPU_SESYNR0_MCDMA_ADDR A:0x35050
y.create.l HWIO_MCDMA_XPU_SESYNR1_MCDMA_ADDR A:0x35054
y.create.l HWIO_MCDMA_XPU_SESYNR2_MCDMA_ADDR A:0x35058
y.create.l HWIO_MCDMA_XPU_MCR_MCDMA_ADDR A:0x35100
y.create.l HWIO_MCDMA_XPU_MEAR0_MCDMA_ADDR A:0x35140
y.create.l HWIO_MCDMA_XPU_MESR_MCDMA_ADDR A:0x35148
y.create.l HWIO_MCDMA_XPU_MESRRESTORE_MCDMA_ADDR A:0x3514c
y.create.l HWIO_MCDMA_XPU_MESYNR0_MCDMA_ADDR A:0x35150
y.create.l HWIO_MCDMA_XPU_MESYNR1_MCDMA_ADDR A:0x35154
y.create.l HWIO_MCDMA_XPU_MESYNR2_MCDMA_ADDR A:0x35158
y.create.l HWIO_MCDMA_XPU_CR_MCDMA_ADDR A:0x35080
y.create.l HWIO_MCDMA_XPU_PRTN_RACR_SHADOW_MCDMA_ADDR A:0x35088
y.create.l HWIO_MCDMA_XPU_PRTN_START_SHADOW0_MCDMA_ADDR A:0x35090
y.create.l HWIO_MCDMA_XPU_PRTN_END_SHADOW0_MCDMA_ADDR A:0x35098
y.create.l HWIO_MCDMA_XPU_RPU_ACR0_MCDMA_ADDR A:0x350a0
y.create.l HWIO_MCDMA_XPU_EAR0_MCDMA_ADDR A:0x350c0
y.create.l HWIO_MCDMA_XPU_ESR_MCDMA_ADDR A:0x350c8
y.create.l HWIO_MCDMA_XPU_ESRRESTORE_MCDMA_ADDR A:0x350cc
y.create.l HWIO_MCDMA_XPU_ESYNR0_MCDMA_ADDR A:0x350d0
y.create.l HWIO_MCDMA_XPU_ESYNR1_MCDMA_ADDR A:0x350d4
y.create.l HWIO_MCDMA_XPU_ESYNR2_MCDMA_ADDR A:0x350d8
y.create.l HWIO_MCDMA_XPU_UMR_RACR_MCDMA_ADDR A:0x350e0
y.create.l HWIO_MCDMA_XPU_UMR_WACR_MCDMA_ADDR A:0x350e4
y.create.l HWIO_MCDMA_XPU_UMR_CNTL_MCDMA_ADDR A:0x350f0
y.create.l HWIO_MCDMA_XPU_IDR0_MCDMA_ADDR A:0x35074
y.create.l HWIO_MCDMA_XPU_IDR1_MCDMA_ADDR A:0x35078
y.create.l HWIO_MCDMA_XPU_REV_MCDMA_ADDR A:0x3507c
y.create.l HWIO_MCDMA_XPU_PRT0_RACR0_MCDMA_ADDR A:0x35200
y.create.l HWIO_MCDMA_XPU_PRT1_RACR0_MCDMA_ADDR A:0x35280
y.create.l HWIO_MCDMA_XPU_PRT2_RACR0_MCDMA_ADDR A:0x35300
y.create.l HWIO_MCDMA_XPU_PRT3_RACR0_MCDMA_ADDR A:0x35380
y.create.l HWIO_MCDMA_XPU_PRT4_RACR0_MCDMA_ADDR A:0x35400
y.create.l HWIO_MCDMA_XPU_PRT5_RACR0_MCDMA_ADDR A:0x35480
y.create.l HWIO_MCDMA_XPU_PRT6_RACR0_MCDMA_ADDR A:0x35500
y.create.l HWIO_MCDMA_XPU_PRT7_RACR0_MCDMA_ADDR A:0x35580
y.create.l HWIO_MCDMA_XPU_PRT8_RACR0_MCDMA_ADDR A:0x35600
y.create.l HWIO_MCDMA_XPU_PRT9_RACR0_MCDMA_ADDR A:0x35680
y.create.l HWIO_MCDMA_XPU_PRT0_START0_MCDMA_ADDR A:0x35240
y.create.l HWIO_MCDMA_XPU_PRT1_START0_MCDMA_ADDR A:0x352c0
y.create.l HWIO_MCDMA_XPU_PRT2_START0_MCDMA_ADDR A:0x35340
y.create.l HWIO_MCDMA_XPU_PRT3_START0_MCDMA_ADDR A:0x353c0
y.create.l HWIO_MCDMA_XPU_PRT4_START0_MCDMA_ADDR A:0x35440
y.create.l HWIO_MCDMA_XPU_PRT5_START0_MCDMA_ADDR A:0x354c0
y.create.l HWIO_MCDMA_XPU_PRT6_START0_MCDMA_ADDR A:0x35540
y.create.l HWIO_MCDMA_XPU_PRT7_START0_MCDMA_ADDR A:0x355c0
y.create.l HWIO_MCDMA_XPU_PRT8_START0_MCDMA_ADDR A:0x35640
y.create.l HWIO_MCDMA_XPU_PRT9_START0_MCDMA_ADDR A:0x356c0
y.create.l HWIO_MCDMA_XPU_PRT0_END0_MCDMA_ADDR A:0x35248
y.create.l HWIO_MCDMA_XPU_PRT1_END0_MCDMA_ADDR A:0x352c8
y.create.l HWIO_MCDMA_XPU_PRT2_END0_MCDMA_ADDR A:0x35348
y.create.l HWIO_MCDMA_XPU_PRT3_END0_MCDMA_ADDR A:0x353c8
y.create.l HWIO_MCDMA_XPU_PRT4_END0_MCDMA_ADDR A:0x35448
y.create.l HWIO_MCDMA_XPU_PRT5_END0_MCDMA_ADDR A:0x354c8
y.create.l HWIO_MCDMA_XPU_PRT6_END0_MCDMA_ADDR A:0x35548
y.create.l HWIO_MCDMA_XPU_PRT7_END0_MCDMA_ADDR A:0x355c8
y.create.l HWIO_MCDMA_XPU_PRT8_END0_MCDMA_ADDR A:0x35648
y.create.l HWIO_MCDMA_XPU_PRT9_END0_MCDMA_ADDR A:0x356c8
y.create.l HWIO_MCDMA_XPU_PRT0_SCR_MCDMA_ADDR A:0x35250
y.create.l HWIO_MCDMA_XPU_PRT1_SCR_MCDMA_ADDR A:0x352d0
y.create.l HWIO_MCDMA_XPU_PRT2_SCR_MCDMA_ADDR A:0x35350
y.create.l HWIO_MCDMA_XPU_PRT3_SCR_MCDMA_ADDR A:0x353d0
y.create.l HWIO_MCDMA_XPU_PRT4_SCR_MCDMA_ADDR A:0x35450
y.create.l HWIO_MCDMA_XPU_PRT5_SCR_MCDMA_ADDR A:0x354d0
y.create.l HWIO_MCDMA_XPU_PRT6_SCR_MCDMA_ADDR A:0x35550
y.create.l HWIO_MCDMA_XPU_PRT7_SCR_MCDMA_ADDR A:0x355d0
y.create.l HWIO_MCDMA_XPU_PRT8_SCR_MCDMA_ADDR A:0x35650
y.create.l HWIO_MCDMA_XPU_PRT9_SCR_MCDMA_ADDR A:0x356d0
y.create.l HWIO_MCDMA_XPU_PRT0_MCR_MCDMA_ADDR A:0x35254
y.create.l HWIO_MCDMA_XPU_PRT1_MCR_MCDMA_ADDR A:0x352d4
y.create.l HWIO_MCDMA_XPU_PRT2_MCR_MCDMA_ADDR A:0x35354
y.create.l HWIO_MCDMA_XPU_PRT3_MCR_MCDMA_ADDR A:0x353d4
y.create.l HWIO_MCDMA_XPU_PRT4_MCR_MCDMA_ADDR A:0x35454
y.create.l HWIO_MCDMA_XPU_PRT5_MCR_MCDMA_ADDR A:0x354d4
y.create.l HWIO_MCDMA_XPU_PRT6_MCR_MCDMA_ADDR A:0x35554
y.create.l HWIO_MCDMA_XPU_PRT7_MCR_MCDMA_ADDR A:0x355d4
y.create.l HWIO_MCDMA_XPU_PRT8_MCR_MCDMA_ADDR A:0x35654
y.create.l HWIO_MCDMA_XPU_PRT9_MCR_MCDMA_ADDR A:0x356d4
y.create.l HWIO_MCDMA_XPU_PRT0_CNTL0_MCDMA_ADDR A:0x35258
y.create.l HWIO_MCDMA_XPU_PRT1_CNTL0_MCDMA_ADDR A:0x352d8
y.create.l HWIO_MCDMA_XPU_PRT2_CNTL0_MCDMA_ADDR A:0x35358
y.create.l HWIO_MCDMA_XPU_PRT3_CNTL0_MCDMA_ADDR A:0x353d8
y.create.l HWIO_MCDMA_XPU_PRT4_CNTL0_MCDMA_ADDR A:0x35458
y.create.l HWIO_MCDMA_XPU_PRT5_CNTL0_MCDMA_ADDR A:0x354d8
y.create.l HWIO_MCDMA_XPU_PRT6_CNTL0_MCDMA_ADDR A:0x35558
y.create.l HWIO_MCDMA_XPU_PRT7_CNTL0_MCDMA_ADDR A:0x355d8
y.create.l HWIO_MCDMA_XPU_PRT8_CNTL0_MCDMA_ADDR A:0x35658
y.create.l HWIO_MCDMA_XPU_PRT9_CNTL0_MCDMA_ADDR A:0x356d8
y.create.l HWIO_MCDMA_XPU_PRT0_CNTL1_MCDMA_ADDR A:0x3525c
y.create.l HWIO_MCDMA_XPU_PRT1_CNTL1_MCDMA_ADDR A:0x352dc
y.create.l HWIO_MCDMA_XPU_PRT2_CNTL1_MCDMA_ADDR A:0x3535c
y.create.l HWIO_MCDMA_XPU_PRT3_CNTL1_MCDMA_ADDR A:0x353dc
y.create.l HWIO_MCDMA_XPU_PRT4_CNTL1_MCDMA_ADDR A:0x3545c
y.create.l HWIO_MCDMA_XPU_PRT5_CNTL1_MCDMA_ADDR A:0x354dc
y.create.l HWIO_MCDMA_XPU_PRT6_CNTL1_MCDMA_ADDR A:0x3555c
y.create.l HWIO_MCDMA_XPU_PRT7_CNTL1_MCDMA_ADDR A:0x355dc
y.create.l HWIO_MCDMA_XPU_PRT8_CNTL1_MCDMA_ADDR A:0x3565c
y.create.l HWIO_MCDMA_XPU_PRT9_CNTL1_MCDMA_ADDR A:0x356dc
y.create.l HWIO_QDSP_XPU_SCR_QDSP_ADDR A:0x37000
y.create.l HWIO_QDSP_XPU_SWDR_QDSP_ADDR A:0x37004
y.create.l HWIO_QDSP_XPU_PRTN_RACR_SSHADOW_QDSP_ADDR A:0x37008
y.create.l HWIO_QDSP_XPU_PRTN_START_SSHADOW0_QDSP_ADDR A:0x37010
y.create.l HWIO_QDSP_XPU_PRTN_END_SSHADOW0_QDSP_ADDR A:0x37018
y.create.l HWIO_QDSP_XPU_SEAR0_QDSP_ADDR A:0x37040
y.create.l HWIO_QDSP_XPU_SESR_QDSP_ADDR A:0x37048
y.create.l HWIO_QDSP_XPU_SESRRESTORE_QDSP_ADDR A:0x3704c
y.create.l HWIO_QDSP_XPU_SESYNR0_QDSP_ADDR A:0x37050
y.create.l HWIO_QDSP_XPU_SESYNR1_QDSP_ADDR A:0x37054
y.create.l HWIO_QDSP_XPU_SESYNR2_QDSP_ADDR A:0x37058
y.create.l HWIO_QDSP_XPU_MCR_QDSP_ADDR A:0x37100
y.create.l HWIO_QDSP_XPU_MEAR0_QDSP_ADDR A:0x37140
y.create.l HWIO_QDSP_XPU_MESR_QDSP_ADDR A:0x37148
y.create.l HWIO_QDSP_XPU_MESRRESTORE_QDSP_ADDR A:0x3714c
y.create.l HWIO_QDSP_XPU_MESYNR0_QDSP_ADDR A:0x37150
y.create.l HWIO_QDSP_XPU_MESYNR1_QDSP_ADDR A:0x37154
y.create.l HWIO_QDSP_XPU_MESYNR2_QDSP_ADDR A:0x37158
y.create.l HWIO_QDSP_XPU_CR_QDSP_ADDR A:0x37080
y.create.l HWIO_QDSP_XPU_PRTN_RACR_SHADOW_QDSP_ADDR A:0x37088
y.create.l HWIO_QDSP_XPU_PRTN_START_SHADOW0_QDSP_ADDR A:0x37090
y.create.l HWIO_QDSP_XPU_PRTN_END_SHADOW0_QDSP_ADDR A:0x37098
y.create.l HWIO_QDSP_XPU_RPU_ACR0_QDSP_ADDR A:0x370a0
y.create.l HWIO_QDSP_XPU_EAR0_QDSP_ADDR A:0x370c0
y.create.l HWIO_QDSP_XPU_ESR_QDSP_ADDR A:0x370c8
y.create.l HWIO_QDSP_XPU_ESRRESTORE_QDSP_ADDR A:0x370cc
y.create.l HWIO_QDSP_XPU_ESYNR0_QDSP_ADDR A:0x370d0
y.create.l HWIO_QDSP_XPU_ESYNR1_QDSP_ADDR A:0x370d4
y.create.l HWIO_QDSP_XPU_ESYNR2_QDSP_ADDR A:0x370d8
y.create.l HWIO_QDSP_XPU_UMR_RACR_QDSP_ADDR A:0x370e0
y.create.l HWIO_QDSP_XPU_UMR_WACR_QDSP_ADDR A:0x370e4
y.create.l HWIO_QDSP_XPU_UMR_CNTL_QDSP_ADDR A:0x370f0
y.create.l HWIO_QDSP_XPU_IDR0_QDSP_ADDR A:0x37074
y.create.l HWIO_QDSP_XPU_IDR1_QDSP_ADDR A:0x37078
y.create.l HWIO_QDSP_XPU_REV_QDSP_ADDR A:0x3707c
y.create.l HWIO_QDSP_XPU_PRT0_RACR0_QDSP_ADDR A:0x37200
y.create.l HWIO_QDSP_XPU_PRT1_RACR0_QDSP_ADDR A:0x37280
y.create.l HWIO_QDSP_XPU_PRT2_RACR0_QDSP_ADDR A:0x37300
y.create.l HWIO_QDSP_XPU_PRT3_RACR0_QDSP_ADDR A:0x37380
y.create.l HWIO_QDSP_XPU_PRT4_RACR0_QDSP_ADDR A:0x37400
y.create.l HWIO_QDSP_XPU_PRT5_RACR0_QDSP_ADDR A:0x37480
y.create.l HWIO_QDSP_XPU_PRT6_RACR0_QDSP_ADDR A:0x37500
y.create.l HWIO_QDSP_XPU_PRT7_RACR0_QDSP_ADDR A:0x37580
y.create.l HWIO_QDSP_XPU_PRT8_RACR0_QDSP_ADDR A:0x37600
y.create.l HWIO_QDSP_XPU_PRT9_RACR0_QDSP_ADDR A:0x37680
y.create.l HWIO_QDSP_XPU_PRT0_START0_QDSP_ADDR A:0x37240
y.create.l HWIO_QDSP_XPU_PRT1_START0_QDSP_ADDR A:0x372c0
y.create.l HWIO_QDSP_XPU_PRT2_START0_QDSP_ADDR A:0x37340
y.create.l HWIO_QDSP_XPU_PRT3_START0_QDSP_ADDR A:0x373c0
y.create.l HWIO_QDSP_XPU_PRT4_START0_QDSP_ADDR A:0x37440
y.create.l HWIO_QDSP_XPU_PRT5_START0_QDSP_ADDR A:0x374c0
y.create.l HWIO_QDSP_XPU_PRT6_START0_QDSP_ADDR A:0x37540
y.create.l HWIO_QDSP_XPU_PRT7_START0_QDSP_ADDR A:0x375c0
y.create.l HWIO_QDSP_XPU_PRT8_START0_QDSP_ADDR A:0x37640
y.create.l HWIO_QDSP_XPU_PRT9_START0_QDSP_ADDR A:0x376c0
y.create.l HWIO_QDSP_XPU_PRT0_END0_QDSP_ADDR A:0x37248
y.create.l HWIO_QDSP_XPU_PRT1_END0_QDSP_ADDR A:0x372c8
y.create.l HWIO_QDSP_XPU_PRT2_END0_QDSP_ADDR A:0x37348
y.create.l HWIO_QDSP_XPU_PRT3_END0_QDSP_ADDR A:0x373c8
y.create.l HWIO_QDSP_XPU_PRT4_END0_QDSP_ADDR A:0x37448
y.create.l HWIO_QDSP_XPU_PRT5_END0_QDSP_ADDR A:0x374c8
y.create.l HWIO_QDSP_XPU_PRT6_END0_QDSP_ADDR A:0x37548
y.create.l HWIO_QDSP_XPU_PRT7_END0_QDSP_ADDR A:0x375c8
y.create.l HWIO_QDSP_XPU_PRT8_END0_QDSP_ADDR A:0x37648
y.create.l HWIO_QDSP_XPU_PRT9_END0_QDSP_ADDR A:0x376c8
y.create.l HWIO_QDSP_XPU_PRT0_SCR_QDSP_ADDR A:0x37250
y.create.l HWIO_QDSP_XPU_PRT1_SCR_QDSP_ADDR A:0x372d0
y.create.l HWIO_QDSP_XPU_PRT2_SCR_QDSP_ADDR A:0x37350
y.create.l HWIO_QDSP_XPU_PRT3_SCR_QDSP_ADDR A:0x373d0
y.create.l HWIO_QDSP_XPU_PRT4_SCR_QDSP_ADDR A:0x37450
y.create.l HWIO_QDSP_XPU_PRT5_SCR_QDSP_ADDR A:0x374d0
y.create.l HWIO_QDSP_XPU_PRT6_SCR_QDSP_ADDR A:0x37550
y.create.l HWIO_QDSP_XPU_PRT7_SCR_QDSP_ADDR A:0x375d0
y.create.l HWIO_QDSP_XPU_PRT8_SCR_QDSP_ADDR A:0x37650
y.create.l HWIO_QDSP_XPU_PRT9_SCR_QDSP_ADDR A:0x376d0
y.create.l HWIO_QDSP_XPU_PRT0_MCR_QDSP_ADDR A:0x37254
y.create.l HWIO_QDSP_XPU_PRT1_MCR_QDSP_ADDR A:0x372d4
y.create.l HWIO_QDSP_XPU_PRT2_MCR_QDSP_ADDR A:0x37354
y.create.l HWIO_QDSP_XPU_PRT3_MCR_QDSP_ADDR A:0x373d4
y.create.l HWIO_QDSP_XPU_PRT4_MCR_QDSP_ADDR A:0x37454
y.create.l HWIO_QDSP_XPU_PRT5_MCR_QDSP_ADDR A:0x374d4
y.create.l HWIO_QDSP_XPU_PRT6_MCR_QDSP_ADDR A:0x37554
y.create.l HWIO_QDSP_XPU_PRT7_MCR_QDSP_ADDR A:0x375d4
y.create.l HWIO_QDSP_XPU_PRT8_MCR_QDSP_ADDR A:0x37654
y.create.l HWIO_QDSP_XPU_PRT9_MCR_QDSP_ADDR A:0x376d4
y.create.l HWIO_QDSP_XPU_PRT0_CNTL0_QDSP_ADDR A:0x37258
y.create.l HWIO_QDSP_XPU_PRT1_CNTL0_QDSP_ADDR A:0x372d8
y.create.l HWIO_QDSP_XPU_PRT2_CNTL0_QDSP_ADDR A:0x37358
y.create.l HWIO_QDSP_XPU_PRT3_CNTL0_QDSP_ADDR A:0x373d8
y.create.l HWIO_QDSP_XPU_PRT4_CNTL0_QDSP_ADDR A:0x37458
y.create.l HWIO_QDSP_XPU_PRT5_CNTL0_QDSP_ADDR A:0x374d8
y.create.l HWIO_QDSP_XPU_PRT6_CNTL0_QDSP_ADDR A:0x37558
y.create.l HWIO_QDSP_XPU_PRT7_CNTL0_QDSP_ADDR A:0x375d8
y.create.l HWIO_QDSP_XPU_PRT8_CNTL0_QDSP_ADDR A:0x37658
y.create.l HWIO_QDSP_XPU_PRT9_CNTL0_QDSP_ADDR A:0x376d8
y.create.l HWIO_QDSP_XPU_PRT0_CNTL1_QDSP_ADDR A:0x3725c
y.create.l HWIO_QDSP_XPU_PRT1_CNTL1_QDSP_ADDR A:0x372dc
y.create.l HWIO_QDSP_XPU_PRT2_CNTL1_QDSP_ADDR A:0x3735c
y.create.l HWIO_QDSP_XPU_PRT3_CNTL1_QDSP_ADDR A:0x373dc
y.create.l HWIO_QDSP_XPU_PRT4_CNTL1_QDSP_ADDR A:0x3745c
y.create.l HWIO_QDSP_XPU_PRT5_CNTL1_QDSP_ADDR A:0x374dc
y.create.l HWIO_QDSP_XPU_PRT6_CNTL1_QDSP_ADDR A:0x3755c
y.create.l HWIO_QDSP_XPU_PRT7_CNTL1_QDSP_ADDR A:0x375dc
y.create.l HWIO_QDSP_XPU_PRT8_CNTL1_QDSP_ADDR A:0x3765c
y.create.l HWIO_QDSP_XPU_PRT9_CNTL1_QDSP_ADDR A:0x376dc
y.create.l HWIO_GPS_XPU_SCR_GPS_ADDR A:0x36000
y.create.l HWIO_GPS_XPU_SWDR_GPS_ADDR A:0x36004
y.create.l HWIO_GPS_XPU_PRTN_RACR_SSHADOW_GPS_ADDR A:0x36008
y.create.l HWIO_GPS_XPU_PRTN_START_SSHADOW0_GPS_ADDR A:0x36010
y.create.l HWIO_GPS_XPU_PRTN_END_SSHADOW0_GPS_ADDR A:0x36018
y.create.l HWIO_GPS_XPU_SEAR0_GPS_ADDR A:0x36040
y.create.l HWIO_GPS_XPU_SESR_GPS_ADDR A:0x36048
y.create.l HWIO_GPS_XPU_SESRRESTORE_GPS_ADDR A:0x3604c
y.create.l HWIO_GPS_XPU_SESYNR0_GPS_ADDR A:0x36050
y.create.l HWIO_GPS_XPU_SESYNR1_GPS_ADDR A:0x36054
y.create.l HWIO_GPS_XPU_SESYNR2_GPS_ADDR A:0x36058
y.create.l HWIO_GPS_XPU_MCR_GPS_ADDR A:0x36100
y.create.l HWIO_GPS_XPU_MEAR0_GPS_ADDR A:0x36140
y.create.l HWIO_GPS_XPU_MESR_GPS_ADDR A:0x36148
y.create.l HWIO_GPS_XPU_MESRRESTORE_GPS_ADDR A:0x3614c
y.create.l HWIO_GPS_XPU_MESYNR0_GPS_ADDR A:0x36150
y.create.l HWIO_GPS_XPU_MESYNR1_GPS_ADDR A:0x36154
y.create.l HWIO_GPS_XPU_MESYNR2_GPS_ADDR A:0x36158
y.create.l HWIO_GPS_XPU_CR_GPS_ADDR A:0x36080
y.create.l HWIO_GPS_XPU_PRTN_RACR_SHADOW_GPS_ADDR A:0x36088
y.create.l HWIO_GPS_XPU_PRTN_START_SHADOW0_GPS_ADDR A:0x36090
y.create.l HWIO_GPS_XPU_PRTN_END_SHADOW0_GPS_ADDR A:0x36098
y.create.l HWIO_GPS_XPU_RPU_ACR0_GPS_ADDR A:0x360a0
y.create.l HWIO_GPS_XPU_EAR0_GPS_ADDR A:0x360c0
y.create.l HWIO_GPS_XPU_ESR_GPS_ADDR A:0x360c8
y.create.l HWIO_GPS_XPU_ESRRESTORE_GPS_ADDR A:0x360cc
y.create.l HWIO_GPS_XPU_ESYNR0_GPS_ADDR A:0x360d0
y.create.l HWIO_GPS_XPU_ESYNR1_GPS_ADDR A:0x360d4
y.create.l HWIO_GPS_XPU_ESYNR2_GPS_ADDR A:0x360d8
y.create.l HWIO_GPS_XPU_UMR_RACR_GPS_ADDR A:0x360e0
y.create.l HWIO_GPS_XPU_UMR_WACR_GPS_ADDR A:0x360e4
y.create.l HWIO_GPS_XPU_UMR_CNTL_GPS_ADDR A:0x360f0
y.create.l HWIO_GPS_XPU_IDR0_GPS_ADDR A:0x36074
y.create.l HWIO_GPS_XPU_IDR1_GPS_ADDR A:0x36078
y.create.l HWIO_GPS_XPU_REV_GPS_ADDR A:0x3607c
y.create.l HWIO_GPS_XPU_PRT0_RACR0_GPS_ADDR A:0x36200
y.create.l HWIO_GPS_XPU_PRT1_RACR0_GPS_ADDR A:0x36280
y.create.l HWIO_GPS_XPU_PRT2_RACR0_GPS_ADDR A:0x36300
y.create.l HWIO_GPS_XPU_PRT3_RACR0_GPS_ADDR A:0x36380
y.create.l HWIO_GPS_XPU_PRT4_RACR0_GPS_ADDR A:0x36400
y.create.l HWIO_GPS_XPU_PRT5_RACR0_GPS_ADDR A:0x36480
y.create.l HWIO_GPS_XPU_PRT6_RACR0_GPS_ADDR A:0x36500
y.create.l HWIO_GPS_XPU_PRT7_RACR0_GPS_ADDR A:0x36580
y.create.l HWIO_GPS_XPU_PRT8_RACR0_GPS_ADDR A:0x36600
y.create.l HWIO_GPS_XPU_PRT9_RACR0_GPS_ADDR A:0x36680
y.create.l HWIO_GPS_XPU_PRT0_START0_GPS_ADDR A:0x36240
y.create.l HWIO_GPS_XPU_PRT1_START0_GPS_ADDR A:0x362c0
y.create.l HWIO_GPS_XPU_PRT2_START0_GPS_ADDR A:0x36340
y.create.l HWIO_GPS_XPU_PRT3_START0_GPS_ADDR A:0x363c0
y.create.l HWIO_GPS_XPU_PRT4_START0_GPS_ADDR A:0x36440
y.create.l HWIO_GPS_XPU_PRT5_START0_GPS_ADDR A:0x364c0
y.create.l HWIO_GPS_XPU_PRT6_START0_GPS_ADDR A:0x36540
y.create.l HWIO_GPS_XPU_PRT7_START0_GPS_ADDR A:0x365c0
y.create.l HWIO_GPS_XPU_PRT8_START0_GPS_ADDR A:0x36640
y.create.l HWIO_GPS_XPU_PRT9_START0_GPS_ADDR A:0x366c0
y.create.l HWIO_GPS_XPU_PRT0_END0_GPS_ADDR A:0x36248
y.create.l HWIO_GPS_XPU_PRT1_END0_GPS_ADDR A:0x362c8
y.create.l HWIO_GPS_XPU_PRT2_END0_GPS_ADDR A:0x36348
y.create.l HWIO_GPS_XPU_PRT3_END0_GPS_ADDR A:0x363c8
y.create.l HWIO_GPS_XPU_PRT4_END0_GPS_ADDR A:0x36448
y.create.l HWIO_GPS_XPU_PRT5_END0_GPS_ADDR A:0x364c8
y.create.l HWIO_GPS_XPU_PRT6_END0_GPS_ADDR A:0x36548
y.create.l HWIO_GPS_XPU_PRT7_END0_GPS_ADDR A:0x365c8
y.create.l HWIO_GPS_XPU_PRT8_END0_GPS_ADDR A:0x36648
y.create.l HWIO_GPS_XPU_PRT9_END0_GPS_ADDR A:0x366c8
y.create.l HWIO_GPS_XPU_PRT0_SCR_GPS_ADDR A:0x36250
y.create.l HWIO_GPS_XPU_PRT1_SCR_GPS_ADDR A:0x362d0
y.create.l HWIO_GPS_XPU_PRT2_SCR_GPS_ADDR A:0x36350
y.create.l HWIO_GPS_XPU_PRT3_SCR_GPS_ADDR A:0x363d0
y.create.l HWIO_GPS_XPU_PRT4_SCR_GPS_ADDR A:0x36450
y.create.l HWIO_GPS_XPU_PRT5_SCR_GPS_ADDR A:0x364d0
y.create.l HWIO_GPS_XPU_PRT6_SCR_GPS_ADDR A:0x36550
y.create.l HWIO_GPS_XPU_PRT7_SCR_GPS_ADDR A:0x365d0
y.create.l HWIO_GPS_XPU_PRT8_SCR_GPS_ADDR A:0x36650
y.create.l HWIO_GPS_XPU_PRT9_SCR_GPS_ADDR A:0x366d0
y.create.l HWIO_GPS_XPU_PRT0_MCR_GPS_ADDR A:0x36254
y.create.l HWIO_GPS_XPU_PRT1_MCR_GPS_ADDR A:0x362d4
y.create.l HWIO_GPS_XPU_PRT2_MCR_GPS_ADDR A:0x36354
y.create.l HWIO_GPS_XPU_PRT3_MCR_GPS_ADDR A:0x363d4
y.create.l HWIO_GPS_XPU_PRT4_MCR_GPS_ADDR A:0x36454
y.create.l HWIO_GPS_XPU_PRT5_MCR_GPS_ADDR A:0x364d4
y.create.l HWIO_GPS_XPU_PRT6_MCR_GPS_ADDR A:0x36554
y.create.l HWIO_GPS_XPU_PRT7_MCR_GPS_ADDR A:0x365d4
y.create.l HWIO_GPS_XPU_PRT8_MCR_GPS_ADDR A:0x36654
y.create.l HWIO_GPS_XPU_PRT9_MCR_GPS_ADDR A:0x366d4
y.create.l HWIO_GPS_XPU_PRT0_CNTL0_GPS_ADDR A:0x36258
y.create.l HWIO_GPS_XPU_PRT1_CNTL0_GPS_ADDR A:0x362d8
y.create.l HWIO_GPS_XPU_PRT2_CNTL0_GPS_ADDR A:0x36358
y.create.l HWIO_GPS_XPU_PRT3_CNTL0_GPS_ADDR A:0x363d8
y.create.l HWIO_GPS_XPU_PRT4_CNTL0_GPS_ADDR A:0x36458
y.create.l HWIO_GPS_XPU_PRT5_CNTL0_GPS_ADDR A:0x364d8
y.create.l HWIO_GPS_XPU_PRT6_CNTL0_GPS_ADDR A:0x36558
y.create.l HWIO_GPS_XPU_PRT7_CNTL0_GPS_ADDR A:0x365d8
y.create.l HWIO_GPS_XPU_PRT8_CNTL0_GPS_ADDR A:0x36658
y.create.l HWIO_GPS_XPU_PRT9_CNTL0_GPS_ADDR A:0x366d8
y.create.l HWIO_GPS_XPU_PRT0_CNTL1_GPS_ADDR A:0x3625c
y.create.l HWIO_GPS_XPU_PRT1_CNTL1_GPS_ADDR A:0x362dc
y.create.l HWIO_GPS_XPU_PRT2_CNTL1_GPS_ADDR A:0x3635c
y.create.l HWIO_GPS_XPU_PRT3_CNTL1_GPS_ADDR A:0x363dc
y.create.l HWIO_GPS_XPU_PRT4_CNTL1_GPS_ADDR A:0x3645c
y.create.l HWIO_GPS_XPU_PRT5_CNTL1_GPS_ADDR A:0x364dc
y.create.l HWIO_GPS_XPU_PRT6_CNTL1_GPS_ADDR A:0x3655c
y.create.l HWIO_GPS_XPU_PRT7_CNTL1_GPS_ADDR A:0x365dc
y.create.l HWIO_GPS_XPU_PRT8_CNTL1_GPS_ADDR A:0x3665c
y.create.l HWIO_GPS_XPU_PRT9_CNTL1_GPS_ADDR A:0x366dc
y.create.l HWIO_APPS_SMMU_SCR0_APPS_ADDR A:0x1e00000
y.create.l HWIO_APPS_SMMU_NSCR0_APPS_ADDR A:0x1e00400
y.create.l HWIO_APPS_SMMU_SCR1_APPS_ADDR A:0x1e00004
y.create.l HWIO_APPS_SMMU_SACR_APPS_ADDR A:0x1e00010
y.create.l HWIO_APPS_SMMU_NSACR_APPS_ADDR A:0x1e00410
y.create.l HWIO_APPS_SMMU_SIDR0_APPS_ADDR A:0x1e00020
y.create.l HWIO_APPS_SMMU_SIDR1_APPS_ADDR A:0x1e00024
y.create.l HWIO_APPS_SMMU_SIDR2_APPS_ADDR A:0x1e00028
y.create.l HWIO_APPS_SMMU_SIDR7_APPS_ADDR A:0x1e0003c
y.create.l HWIO_APPS_SMMU_SGFAR_LOW_APPS_ADDR A:0x1e00040
y.create.l HWIO_APPS_SMMU_SGFAR_HIGH_APPS_ADDR A:0x1e00044
y.create.l HWIO_APPS_SMMU_NSGFAR_LOW_APPS_ADDR A:0x1e00440
y.create.l HWIO_APPS_SMMU_NSGFAR_HIGH_APPS_ADDR A:0x1e00444
y.create.l HWIO_APPS_SMMU_SGFSR_APPS_ADDR A:0x1e00048
y.create.l HWIO_APPS_SMMU_NSGFSR_APPS_ADDR A:0x1e00448
y.create.l HWIO_APPS_SMMU_SGFSRRESTORE_APPS_ADDR A:0x1e0004c
y.create.l HWIO_APPS_SMMU_NSGFSRRESTORE_APPS_ADDR A:0x1e0044c
y.create.l HWIO_APPS_SMMU_SGFSYNR0_APPS_ADDR A:0x1e00050
y.create.l HWIO_APPS_SMMU_NSGFSYNR0_APPS_ADDR A:0x1e00450
y.create.l HWIO_APPS_SMMU_SGFSYNR1_APPS_ADDR A:0x1e00054
y.create.l HWIO_APPS_SMMU_NSGFSYNDR1_APPS_ADDR A:0x1e00454
y.create.l HWIO_APPS_SMMU_STLBIALL_APPS_ADDR A:0x1e00060
y.create.l HWIO_APPS_SMMU_TLBIVMID_APPS_ADDR A:0x1e00064
y.create.l HWIO_APPS_SMMU_TLBIALLNSNH_APPS_ADDR A:0x1e00068
y.create.l HWIO_APPS_SMMU_NSTLBGSYNC_APPS_ADDR A:0x1e00470
y.create.l HWIO_APPS_SMMU_STLBGSYNC_APPS_ADDR A:0x1e00070
y.create.l HWIO_APPS_SMMU_STLBGSTATUS_APPS_ADDR A:0x1e00074
y.create.l HWIO_APPS_SMMU_NSTLBGSTATUS_APPS_ADDR A:0x1e00474
y.create.l HWIO_APPS_SMMU_DBGRPTRTBU_APPS_ADDR A:0x1e00080
y.create.l HWIO_APPS_SMMU_DBGRDATATBU_APPS_ADDR A:0x1e00084
y.create.l HWIO_APPS_SMMU_DBGRPTRTCU_APPS_ADDR A:0x1e00088
y.create.l HWIO_APPS_SMMU_DBGRDATATCU_APPS_ADDR A:0x1e0008c
y.create.l HWIO_APPS_SMMU_STLBIVALM_LOW_APPS_ADDR A:0x1e000a0
y.create.l HWIO_APPS_SMMU_STLBIVALM_HIGH_APPS_ADDR A:0x1e000a4
y.create.l HWIO_APPS_SMMU_STLBIVAM_LOW_APPS_ADDR A:0x1e000a8
y.create.l HWIO_APPS_SMMU_STLBIVAM_HIGH_APPS_ADDR A:0x1e000ac
y.create.l HWIO_APPS_SMMU_STLBIALLM_APPS_ADDR A:0x1e000bc
y.create.l HWIO_APPS_SMMU_SMR0_APPS_ADDR A:0x1e00800
y.create.l HWIO_APPS_SMMU_SMR1_APPS_ADDR A:0x1e00804
y.create.l HWIO_APPS_SMMU_SMR2_APPS_ADDR A:0x1e00808
y.create.l HWIO_APPS_SMMU_SMR3_APPS_ADDR A:0x1e0080c
y.create.l HWIO_APPS_SMMU_SMR4_APPS_ADDR A:0x1e00810
y.create.l HWIO_APPS_SMMU_SMR5_APPS_ADDR A:0x1e00814
y.create.l HWIO_APPS_SMMU_SMR6_APPS_ADDR A:0x1e00818
y.create.l HWIO_APPS_SMMU_SMR7_APPS_ADDR A:0x1e0081c
y.create.l HWIO_APPS_SMMU_SMR8_APPS_ADDR A:0x1e00820
y.create.l HWIO_APPS_SMMU_SMR9_APPS_ADDR A:0x1e00824
y.create.l HWIO_APPS_SMMU_SMR10_APPS_ADDR A:0x1e00828
y.create.l HWIO_APPS_SMMU_SMR11_APPS_ADDR A:0x1e0082c
y.create.l HWIO_APPS_SMMU_SMR12_APPS_ADDR A:0x1e00830
y.create.l HWIO_APPS_SMMU_SMR13_APPS_ADDR A:0x1e00834
y.create.l HWIO_APPS_SMMU_SMR14_APPS_ADDR A:0x1e00838
y.create.l HWIO_APPS_SMMU_SMR15_APPS_ADDR A:0x1e0083c
y.create.l HWIO_APPS_SMMU_SMR16_APPS_ADDR A:0x1e00840
y.create.l HWIO_APPS_SMMU_SMR17_APPS_ADDR A:0x1e00844
y.create.l HWIO_APPS_SMMU_SMR18_APPS_ADDR A:0x1e00848
y.create.l HWIO_APPS_SMMU_SMR19_APPS_ADDR A:0x1e0084c
y.create.l HWIO_APPS_SMMU_SMR20_APPS_ADDR A:0x1e00850
y.create.l HWIO_APPS_SMMU_SMR21_APPS_ADDR A:0x1e00854
y.create.l HWIO_APPS_SMMU_SMR22_APPS_ADDR A:0x1e00858
y.create.l HWIO_APPS_SMMU_SMR23_APPS_ADDR A:0x1e0085c
y.create.l HWIO_APPS_SMMU_SMR24_APPS_ADDR A:0x1e00860
y.create.l HWIO_APPS_SMMU_SMR25_APPS_ADDR A:0x1e00864
y.create.l HWIO_APPS_SMMU_SMR26_APPS_ADDR A:0x1e00868
y.create.l HWIO_APPS_SMMU_SMR27_APPS_ADDR A:0x1e0086c
y.create.l HWIO_APPS_SMMU_SMR28_APPS_ADDR A:0x1e00870
y.create.l HWIO_APPS_SMMU_SMR29_APPS_ADDR A:0x1e00874
y.create.l HWIO_APPS_SMMU_SMR30_APPS_ADDR A:0x1e00878
y.create.l HWIO_APPS_SMMU_SMR31_APPS_ADDR A:0x1e0087c
y.create.l HWIO_APPS_SMMU_S2CR0_APPS_ADDR A:0x1e00c00
y.create.l HWIO_APPS_SMMU_S2CR1_APPS_ADDR A:0x1e00c04
y.create.l HWIO_APPS_SMMU_S2CR2_APPS_ADDR A:0x1e00c08
y.create.l HWIO_APPS_SMMU_S2CR3_APPS_ADDR A:0x1e00c0c
y.create.l HWIO_APPS_SMMU_S2CR4_APPS_ADDR A:0x1e00c10
y.create.l HWIO_APPS_SMMU_S2CR5_APPS_ADDR A:0x1e00c14
y.create.l HWIO_APPS_SMMU_S2CR6_APPS_ADDR A:0x1e00c18
y.create.l HWIO_APPS_SMMU_S2CR7_APPS_ADDR A:0x1e00c1c
y.create.l HWIO_APPS_SMMU_S2CR8_APPS_ADDR A:0x1e00c20
y.create.l HWIO_APPS_SMMU_S2CR9_APPS_ADDR A:0x1e00c24
y.create.l HWIO_APPS_SMMU_S2CR10_APPS_ADDR A:0x1e00c28
y.create.l HWIO_APPS_SMMU_S2CR11_APPS_ADDR A:0x1e00c2c
y.create.l HWIO_APPS_SMMU_S2CR12_APPS_ADDR A:0x1e00c30
y.create.l HWIO_APPS_SMMU_S2CR13_APPS_ADDR A:0x1e00c34
y.create.l HWIO_APPS_SMMU_S2CR14_APPS_ADDR A:0x1e00c38
y.create.l HWIO_APPS_SMMU_S2CR15_APPS_ADDR A:0x1e00c3c
y.create.l HWIO_APPS_SMMU_S2CR16_APPS_ADDR A:0x1e00c40
y.create.l HWIO_APPS_SMMU_S2CR17_APPS_ADDR A:0x1e00c44
y.create.l HWIO_APPS_SMMU_S2CR18_APPS_ADDR A:0x1e00c48
y.create.l HWIO_APPS_SMMU_S2CR19_APPS_ADDR A:0x1e00c4c
y.create.l HWIO_APPS_SMMU_S2CR20_APPS_ADDR A:0x1e00c50
y.create.l HWIO_APPS_SMMU_S2CR21_APPS_ADDR A:0x1e00c54
y.create.l HWIO_APPS_SMMU_S2CR22_APPS_ADDR A:0x1e00c58
y.create.l HWIO_APPS_SMMU_S2CR23_APPS_ADDR A:0x1e00c5c
y.create.l HWIO_APPS_SMMU_S2CR24_APPS_ADDR A:0x1e00c60
y.create.l HWIO_APPS_SMMU_S2CR25_APPS_ADDR A:0x1e00c64
y.create.l HWIO_APPS_SMMU_S2CR26_APPS_ADDR A:0x1e00c68
y.create.l HWIO_APPS_SMMU_S2CR27_APPS_ADDR A:0x1e00c6c
y.create.l HWIO_APPS_SMMU_S2CR28_APPS_ADDR A:0x1e00c70
y.create.l HWIO_APPS_SMMU_S2CR29_APPS_ADDR A:0x1e00c74
y.create.l HWIO_APPS_SMMU_S2CR30_APPS_ADDR A:0x1e00c78
y.create.l HWIO_APPS_SMMU_S2CR31_APPS_ADDR A:0x1e00c7c
y.create.l HWIO_APPS_SMMU_PIDR0_APPS_ADDR A:0x1e00fe0
y.create.l HWIO_APPS_SMMU_PIDR1_APPS_ADDR A:0x1e00fe4
y.create.l HWIO_APPS_SMMU_PIDR2_APPS_ADDR A:0x1e00fe8
y.create.l HWIO_APPS_SMMU_PIDR3_APPS_ADDR A:0x1e00fec
y.create.l HWIO_APPS_SMMU_PIDR4_APPS_ADDR A:0x1e00fd0
y.create.l HWIO_APPS_SMMU_PIDR5_APPS_ADDR A:0x1e00fd4
y.create.l HWIO_APPS_SMMU_PIDR6_APPS_ADDR A:0x1e00fd8
y.create.l HWIO_APPS_SMMU_PIDR7_APPS_ADDR A:0x1e00fdc
y.create.l HWIO_APPS_SMMU_CIDR0_APPS_ADDR A:0x1e00ff0
y.create.l HWIO_APPS_SMMU_CIDR1_APPS_ADDR A:0x1e00ff4
y.create.l HWIO_APPS_SMMU_CIDR2_APPS_ADDR A:0x1e00ff8
y.create.l HWIO_APPS_SMMU_CIDR3_APPS_ADDR A:0x1e00ffc
y.create.l HWIO_APPS_SMMU_CBAR0_APPS_ADDR A:0x1e01000
y.create.l HWIO_APPS_SMMU_CBFRSYNRA0_APPS_ADDR A:0x1e01400
y.create.l HWIO_APPS_SMMU_CBA2R0_APPS_ADDR A:0x1e01800
y.create.l HWIO_APPS_SMMU_CBAR1_APPS_ADDR A:0x1e01004
y.create.l HWIO_APPS_SMMU_CBFRSYNRA1_APPS_ADDR A:0x1e01404
y.create.l HWIO_APPS_SMMU_CBA2R1_APPS_ADDR A:0x1e01804
y.create.l HWIO_APPS_SMMU_CBAR2_APPS_ADDR A:0x1e01008
y.create.l HWIO_APPS_SMMU_CBFRSYNRA2_APPS_ADDR A:0x1e01408
y.create.l HWIO_APPS_SMMU_CBA2R2_APPS_ADDR A:0x1e01808
y.create.l HWIO_APPS_SMMU_CBAR3_APPS_ADDR A:0x1e0100c
y.create.l HWIO_APPS_SMMU_CBFRSYNRA3_APPS_ADDR A:0x1e0140c
y.create.l HWIO_APPS_SMMU_CBA2R3_APPS_ADDR A:0x1e0180c
y.create.l HWIO_APPS_SMMU_CBAR4_APPS_ADDR A:0x1e01010
y.create.l HWIO_APPS_SMMU_CBFRSYNRA4_APPS_ADDR A:0x1e01410
y.create.l HWIO_APPS_SMMU_CBA2R4_APPS_ADDR A:0x1e01810
y.create.l HWIO_APPS_SMMU_CBAR5_APPS_ADDR A:0x1e01014
y.create.l HWIO_APPS_SMMU_CBFRSYNRA5_APPS_ADDR A:0x1e01414
y.create.l HWIO_APPS_SMMU_CBA2R5_APPS_ADDR A:0x1e01814
y.create.l HWIO_APPS_SMMU_CBAR6_APPS_ADDR A:0x1e01018
y.create.l HWIO_APPS_SMMU_CBFRSYNRA6_APPS_ADDR A:0x1e01418
y.create.l HWIO_APPS_SMMU_CBA2R6_APPS_ADDR A:0x1e01818
y.create.l HWIO_APPS_SMMU_CBAR7_APPS_ADDR A:0x1e0101c
y.create.l HWIO_APPS_SMMU_CBFRSYNRA7_APPS_ADDR A:0x1e0141c
y.create.l HWIO_APPS_SMMU_CBA2R7_APPS_ADDR A:0x1e0181c
y.create.l HWIO_APPS_SMMU_CBAR8_APPS_ADDR A:0x1e01020
y.create.l HWIO_APPS_SMMU_CBFRSYNRA8_APPS_ADDR A:0x1e01420
y.create.l HWIO_APPS_SMMU_CBA2R8_APPS_ADDR A:0x1e01820
y.create.l HWIO_APPS_SMMU_CBAR9_APPS_ADDR A:0x1e01024
y.create.l HWIO_APPS_SMMU_CBFRSYNRA9_APPS_ADDR A:0x1e01424
y.create.l HWIO_APPS_SMMU_CBA2R9_APPS_ADDR A:0x1e01824
y.create.l HWIO_APPS_SMMU_CBAR10_APPS_ADDR A:0x1e01028
y.create.l HWIO_APPS_SMMU_CBFRSYNRA10_APPS_ADDR A:0x1e01428
y.create.l HWIO_APPS_SMMU_CBA2R10_APPS_ADDR A:0x1e01828
y.create.l HWIO_APPS_SMMU_CBAR11_APPS_ADDR A:0x1e0102c
y.create.l HWIO_APPS_SMMU_CBFRSYNRA11_APPS_ADDR A:0x1e0142c
y.create.l HWIO_APPS_SMMU_CBA2R11_APPS_ADDR A:0x1e0182c
y.create.l HWIO_APPS_SMMU_CBAR12_APPS_ADDR A:0x1e01030
y.create.l HWIO_APPS_SMMU_CBFRSYNRA12_APPS_ADDR A:0x1e01430
y.create.l HWIO_APPS_SMMU_CBA2R12_APPS_ADDR A:0x1e01830
y.create.l HWIO_APPS_SMMU_CBAR13_APPS_ADDR A:0x1e01034
y.create.l HWIO_APPS_SMMU_CBFRSYNRA13_APPS_ADDR A:0x1e01434
y.create.l HWIO_APPS_SMMU_CBA2R13_APPS_ADDR A:0x1e01834
y.create.l HWIO_APPS_SMMU_CBAR14_APPS_ADDR A:0x1e01038
y.create.l HWIO_APPS_SMMU_CBFRSYNRA14_APPS_ADDR A:0x1e01438
y.create.l HWIO_APPS_SMMU_CBA2R14_APPS_ADDR A:0x1e01838
y.create.l HWIO_APPS_SMMU_CBAR15_APPS_ADDR A:0x1e0103c
y.create.l HWIO_APPS_SMMU_CBFRSYNRA15_APPS_ADDR A:0x1e0143c
y.create.l HWIO_APPS_SMMU_CBA2R15_APPS_ADDR A:0x1e0183c
y.create.l HWIO_APPS_SMMU_ITCTRL_APPS_ADDR A:0x1e02000
y.create.l HWIO_APPS_SMMU_ITIP_APPS_ADDR A:0x1e02004
y.create.l HWIO_APPS_SMMU_ITOP_GLBL_APPS_ADDR A:0x1e02008
y.create.l HWIO_APPS_SMMU_ITOP_PERF_INDEX_APPS_ADDR A:0x1e0200c
y.create.l HWIO_APPS_SMMU_ITOP_CXT0TO31_RAM0_APPS_ADDR A:0x1e02010
y.create.l HWIO_APPS_SMMU_TBUQOS0_APPS_ADDR A:0x1e02100
y.create.l HWIO_APPS_SMMU_PER_APPS_ADDR A:0x1e02200
y.create.l HWIO_APPS_SMMU_TBU_PWR_STATUS_APPS_ADDR A:0x1e02204
y.create.l HWIO_APPS_PMEVCNTR0_APPS_ADDR A:0x1e03000
y.create.l HWIO_APPS_PMEVCNTR1_APPS_ADDR A:0x1e03004
y.create.l HWIO_APPS_PMEVCNTR2_APPS_ADDR A:0x1e03008
y.create.l HWIO_APPS_PMEVCNTR3_APPS_ADDR A:0x1e0300c
y.create.l HWIO_APPS_PMEVCNTR4_APPS_ADDR A:0x1e03010
y.create.l HWIO_APPS_PMEVCNTR5_APPS_ADDR A:0x1e03014
y.create.l HWIO_APPS_PMEVCNTR6_APPS_ADDR A:0x1e03018
y.create.l HWIO_APPS_PMEVCNTR7_APPS_ADDR A:0x1e0301c
y.create.l HWIO_APPS_PMEVCNTR8_APPS_ADDR A:0x1e03020
y.create.l HWIO_APPS_PMEVCNTR9_APPS_ADDR A:0x1e03024
y.create.l HWIO_APPS_PMEVCNTR10_APPS_ADDR A:0x1e03028
y.create.l HWIO_APPS_PMEVCNTR11_APPS_ADDR A:0x1e0302c
y.create.l HWIO_APPS_PMEVTYPER0_APPS_ADDR A:0x1e03400
y.create.l HWIO_APPS_PMEVTYPER1_APPS_ADDR A:0x1e03404
y.create.l HWIO_APPS_PMEVTYPER2_APPS_ADDR A:0x1e03408
y.create.l HWIO_APPS_PMEVTYPER3_APPS_ADDR A:0x1e0340c
y.create.l HWIO_APPS_PMEVTYPER4_APPS_ADDR A:0x1e03410
y.create.l HWIO_APPS_PMEVTYPER5_APPS_ADDR A:0x1e03414
y.create.l HWIO_APPS_PMEVTYPER6_APPS_ADDR A:0x1e03418
y.create.l HWIO_APPS_PMEVTYPER7_APPS_ADDR A:0x1e0341c
y.create.l HWIO_APPS_PMEVTYPER8_APPS_ADDR A:0x1e03420
y.create.l HWIO_APPS_PMEVTYPER9_APPS_ADDR A:0x1e03424
y.create.l HWIO_APPS_PMEVTYPER10_APPS_ADDR A:0x1e03428
y.create.l HWIO_APPS_PMEVTYPER11_APPS_ADDR A:0x1e0342c
y.create.l HWIO_APPS_PMCGCR0_APPS_ADDR A:0x1e03800
y.create.l HWIO_APPS_PMCGCR1_APPS_ADDR A:0x1e03804
y.create.l HWIO_APPS_PMCGCR2_APPS_ADDR A:0x1e03808
y.create.l HWIO_APPS_PMCGSMR0_APPS_ADDR A:0x1e03a00
y.create.l HWIO_APPS_PMCGSMR1_APPS_ADDR A:0x1e03a04
y.create.l HWIO_APPS_PMCGSMR2_APPS_ADDR A:0x1e03a08
y.create.l HWIO_APPS_PMCNTENSET_APPS_ADDR A:0x1e03c00
y.create.l HWIO_APPS_PMCNTENCLR_APPS_ADDR A:0x1e03c20
y.create.l HWIO_APPS_PMINTENSET_APPS_ADDR A:0x1e03c40
y.create.l HWIO_APPS_PMINTENCLR_APPS_ADDR A:0x1e03c60
y.create.l HWIO_APPS_PMOVSCLR_APPS_ADDR A:0x1e03c80
y.create.l HWIO_APPS_PMOVSSET_APPS_ADDR A:0x1e03cc0
y.create.l HWIO_APPS_PMCFGR_APPS_ADDR A:0x1e03e00
y.create.l HWIO_APPS_PMCR_APPS_ADDR A:0x1e03e04
y.create.l HWIO_APPS_PMCEID0_APPS_ADDR A:0x1e03e20
y.create.l HWIO_APPS_PMAUTHSTATUS_APPS_ADDR A:0x1e03fb8
y.create.l HWIO_APPS_PMDEVTYPE_APPS_ADDR A:0x1e03fcc
y.create.l HWIO_APPS_SMMU_SSD_REG_0_APPS_ADDR A:0x1e04000
y.create.l HWIO_APPS_SMMU_SSD_REG_1_APPS_ADDR A:0x1e04004
y.create.l HWIO_APPS_SMMU_SSD_REG_2_APPS_ADDR A:0x1e04008
y.create.l HWIO_APPS_SMMU_SSD_REG_3_APPS_ADDR A:0x1e0400c
y.create.l HWIO_APPS_SMMU_SSD_REG_4_APPS_ADDR A:0x1e04010
y.create.l HWIO_APPS_SMMU_SSD_REG_5_APPS_ADDR A:0x1e04014
y.create.l HWIO_APPS_SMMU_SSD_REG_6_APPS_ADDR A:0x1e04018
y.create.l HWIO_APPS_SMMU_SSD_REG_7_APPS_ADDR A:0x1e0401c
y.create.l HWIO_APPS_SMMU_SSD_REG_8_APPS_ADDR A:0x1e04020
y.create.l HWIO_APPS_SMMU_SSD_REG_9_APPS_ADDR A:0x1e04024
y.create.l HWIO_APPS_SMMU_SSD_REG_10_APPS_ADDR A:0x1e04028
y.create.l HWIO_APPS_SMMU_SSD_REG_11_APPS_ADDR A:0x1e0402c
y.create.l HWIO_APPS_SMMU_SSD_REG_12_APPS_ADDR A:0x1e04030
y.create.l HWIO_APPS_SMMU_SSD_REG_13_APPS_ADDR A:0x1e04034
y.create.l HWIO_APPS_SMMU_SSD_REG_14_APPS_ADDR A:0x1e04038
y.create.l HWIO_APPS_SMMU_SSD_REG_15_APPS_ADDR A:0x1e0403c
y.create.l HWIO_APPS_SMMU_SSD_REG_16_APPS_ADDR A:0x1e04040
y.create.l HWIO_APPS_SMMU_SSD_REG_17_APPS_ADDR A:0x1e04044
y.create.l HWIO_APPS_SMMU_SSD_REG_18_APPS_ADDR A:0x1e04048
y.create.l HWIO_APPS_SMMU_SSD_REG_19_APPS_ADDR A:0x1e0404c
y.create.l HWIO_APPS_SMMU_SSD_REG_20_APPS_ADDR A:0x1e04050
y.create.l HWIO_APPS_SMMU_SSD_REG_21_APPS_ADDR A:0x1e04054
y.create.l HWIO_APPS_SMMU_SSD_REG_22_APPS_ADDR A:0x1e04058
y.create.l HWIO_APPS_SMMU_SSD_REG_23_APPS_ADDR A:0x1e0405c
y.create.l HWIO_APPS_SMMU_SSD_REG_24_APPS_ADDR A:0x1e04060
y.create.l HWIO_APPS_SMMU_SSD_REG_25_APPS_ADDR A:0x1e04064
y.create.l HWIO_APPS_SMMU_SSD_REG_26_APPS_ADDR A:0x1e04068
y.create.l HWIO_APPS_SMMU_SSD_REG_27_APPS_ADDR A:0x1e0406c
y.create.l HWIO_APPS_SMMU_SSD_REG_28_APPS_ADDR A:0x1e04070
y.create.l HWIO_APPS_SMMU_SSD_REG_29_APPS_ADDR A:0x1e04074
y.create.l HWIO_APPS_SMMU_SSD_REG_30_APPS_ADDR A:0x1e04078
y.create.l HWIO_APPS_SMMU_SSD_REG_31_APPS_ADDR A:0x1e0407c
y.create.l HWIO_APPS_SMMU_SSD_REG_32_APPS_ADDR A:0x1e04080
y.create.l HWIO_APPS_SMMU_SSD_REG_33_APPS_ADDR A:0x1e04084
y.create.l HWIO_APPS_SMMU_SSD_REG_34_APPS_ADDR A:0x1e04088
y.create.l HWIO_APPS_SMMU_SSD_REG_35_APPS_ADDR A:0x1e0408c
y.create.l HWIO_APPS_SMMU_SSD_REG_36_APPS_ADDR A:0x1e04090
y.create.l HWIO_APPS_SMMU_SSD_REG_37_APPS_ADDR A:0x1e04094
y.create.l HWIO_APPS_SMMU_SSD_REG_38_APPS_ADDR A:0x1e04098
y.create.l HWIO_APPS_SMMU_SSD_REG_39_APPS_ADDR A:0x1e0409c
y.create.l HWIO_APPS_SMMU_SSD_REG_40_APPS_ADDR A:0x1e040a0
y.create.l HWIO_APPS_SMMU_SSD_REG_41_APPS_ADDR A:0x1e040a4
y.create.l HWIO_APPS_SMMU_SSD_REG_42_APPS_ADDR A:0x1e040a8
y.create.l HWIO_APPS_SMMU_SSD_REG_43_APPS_ADDR A:0x1e040ac
y.create.l HWIO_APPS_SMMU_SSD_REG_44_APPS_ADDR A:0x1e040b0
y.create.l HWIO_APPS_SMMU_SSD_REG_45_APPS_ADDR A:0x1e040b4
y.create.l HWIO_APPS_SMMU_SSD_REG_46_APPS_ADDR A:0x1e040b8
y.create.l HWIO_APPS_SMMU_SSD_REG_47_APPS_ADDR A:0x1e040bc
y.create.l HWIO_APPS_SMMU_SSD_REG_48_APPS_ADDR A:0x1e040c0
y.create.l HWIO_APPS_SMMU_SSD_REG_49_APPS_ADDR A:0x1e040c4
y.create.l HWIO_APPS_SMMU_SSD_REG_50_APPS_ADDR A:0x1e040c8
y.create.l HWIO_APPS_SMMU_SSD_REG_51_APPS_ADDR A:0x1e040cc
y.create.l HWIO_APPS_SMMU_SSD_REG_52_APPS_ADDR A:0x1e040d0
y.create.l HWIO_APPS_SMMU_SSD_REG_53_APPS_ADDR A:0x1e040d4
y.create.l HWIO_APPS_SMMU_SSD_REG_54_APPS_ADDR A:0x1e040d8
y.create.l HWIO_APPS_SMMU_SSD_REG_55_APPS_ADDR A:0x1e040dc
y.create.l HWIO_APPS_SMMU_SSD_REG_56_APPS_ADDR A:0x1e040e0
y.create.l HWIO_APPS_SMMU_SSD_REG_57_APPS_ADDR A:0x1e040e4
y.create.l HWIO_APPS_SMMU_SSD_REG_58_APPS_ADDR A:0x1e040e8
y.create.l HWIO_APPS_SMMU_SSD_REG_59_APPS_ADDR A:0x1e040ec
y.create.l HWIO_APPS_SMMU_SSD_REG_60_APPS_ADDR A:0x1e040f0
y.create.l HWIO_APPS_SMMU_SSD_REG_61_APPS_ADDR A:0x1e040f4
y.create.l HWIO_APPS_SMMU_SSD_REG_62_APPS_ADDR A:0x1e040f8
y.create.l HWIO_APPS_SMMU_SSD_REG_63_APPS_ADDR A:0x1e040fc
y.create.l HWIO_APPS_SMMU_SSD_REG_64_APPS_ADDR A:0x1e04100
y.create.l HWIO_APPS_SMMU_SSD_REG_65_APPS_ADDR A:0x1e04104
y.create.l HWIO_APPS_SMMU_SSD_REG_66_APPS_ADDR A:0x1e04108
y.create.l HWIO_APPS_SMMU_SSD_REG_67_APPS_ADDR A:0x1e0410c
y.create.l HWIO_APPS_SMMU_SSD_REG_68_APPS_ADDR A:0x1e04110
y.create.l HWIO_APPS_SMMU_SSD_REG_69_APPS_ADDR A:0x1e04114
y.create.l HWIO_APPS_SMMU_SSD_REG_70_APPS_ADDR A:0x1e04118
y.create.l HWIO_APPS_SMMU_SSD_REG_71_APPS_ADDR A:0x1e0411c
y.create.l HWIO_APPS_SMMU_SSD_REG_72_APPS_ADDR A:0x1e04120
y.create.l HWIO_APPS_SMMU_SSD_REG_73_APPS_ADDR A:0x1e04124
y.create.l HWIO_APPS_SMMU_SSD_REG_74_APPS_ADDR A:0x1e04128
y.create.l HWIO_APPS_SMMU_SSD_REG_75_APPS_ADDR A:0x1e0412c
y.create.l HWIO_APPS_SMMU_SSD_REG_76_APPS_ADDR A:0x1e04130
y.create.l HWIO_APPS_SMMU_SSD_REG_77_APPS_ADDR A:0x1e04134
y.create.l HWIO_APPS_SMMU_SSD_REG_78_APPS_ADDR A:0x1e04138
y.create.l HWIO_APPS_SMMU_SSD_REG_79_APPS_ADDR A:0x1e0413c
y.create.l HWIO_APPS_SMMU_SSD_REG_80_APPS_ADDR A:0x1e04140
y.create.l HWIO_APPS_SMMU_SSD_REG_81_APPS_ADDR A:0x1e04144
y.create.l HWIO_APPS_SMMU_SSD_REG_82_APPS_ADDR A:0x1e04148
y.create.l HWIO_APPS_SMMU_SSD_REG_83_APPS_ADDR A:0x1e0414c
y.create.l HWIO_APPS_SMMU_SSD_REG_84_APPS_ADDR A:0x1e04150
y.create.l HWIO_APPS_SMMU_SSD_REG_85_APPS_ADDR A:0x1e04154
y.create.l HWIO_APPS_SMMU_SSD_REG_86_APPS_ADDR A:0x1e04158
y.create.l HWIO_APPS_SMMU_SSD_REG_87_APPS_ADDR A:0x1e0415c
y.create.l HWIO_APPS_SMMU_SSD_REG_88_APPS_ADDR A:0x1e04160
y.create.l HWIO_APPS_SMMU_SSD_REG_89_APPS_ADDR A:0x1e04164
y.create.l HWIO_APPS_SMMU_SSD_REG_90_APPS_ADDR A:0x1e04168
y.create.l HWIO_APPS_SMMU_SSD_REG_91_APPS_ADDR A:0x1e0416c
y.create.l HWIO_APPS_SMMU_SSD_REG_92_APPS_ADDR A:0x1e04170
y.create.l HWIO_APPS_SMMU_SSD_REG_93_APPS_ADDR A:0x1e04174
y.create.l HWIO_APPS_SMMU_SSD_REG_94_APPS_ADDR A:0x1e04178
y.create.l HWIO_APPS_SMMU_SSD_REG_95_APPS_ADDR A:0x1e0417c
y.create.l HWIO_APPS_SMMU_SSD_REG_96_APPS_ADDR A:0x1e04180
y.create.l HWIO_APPS_SMMU_SSD_REG_97_APPS_ADDR A:0x1e04184
y.create.l HWIO_APPS_SMMU_SSD_REG_98_APPS_ADDR A:0x1e04188
y.create.l HWIO_APPS_SMMU_SSD_REG_99_APPS_ADDR A:0x1e0418c
y.create.l HWIO_APPS_SMMU_SSD_REG_100_APPS_ADDR A:0x1e04190
y.create.l HWIO_APPS_SMMU_SSD_REG_101_APPS_ADDR A:0x1e04194
y.create.l HWIO_APPS_SMMU_SSD_REG_102_APPS_ADDR A:0x1e04198
y.create.l HWIO_APPS_SMMU_SSD_REG_103_APPS_ADDR A:0x1e0419c
y.create.l HWIO_APPS_SMMU_SSD_REG_104_APPS_ADDR A:0x1e041a0
y.create.l HWIO_APPS_SMMU_SSD_REG_105_APPS_ADDR A:0x1e041a4
y.create.l HWIO_APPS_SMMU_SSD_REG_106_APPS_ADDR A:0x1e041a8
y.create.l HWIO_APPS_SMMU_SSD_REG_107_APPS_ADDR A:0x1e041ac
y.create.l HWIO_APPS_SMMU_SSD_REG_108_APPS_ADDR A:0x1e041b0
y.create.l HWIO_APPS_SMMU_SSD_REG_109_APPS_ADDR A:0x1e041b4
y.create.l HWIO_APPS_SMMU_SSD_REG_110_APPS_ADDR A:0x1e041b8
y.create.l HWIO_APPS_SMMU_SSD_REG_111_APPS_ADDR A:0x1e041bc
y.create.l HWIO_APPS_SMMU_SSD_REG_112_APPS_ADDR A:0x1e041c0
y.create.l HWIO_APPS_SMMU_SSD_REG_113_APPS_ADDR A:0x1e041c4
y.create.l HWIO_APPS_SMMU_SSD_REG_114_APPS_ADDR A:0x1e041c8
y.create.l HWIO_APPS_SMMU_SSD_REG_115_APPS_ADDR A:0x1e041cc
y.create.l HWIO_APPS_SMMU_SSD_REG_116_APPS_ADDR A:0x1e041d0
y.create.l HWIO_APPS_SMMU_SSD_REG_117_APPS_ADDR A:0x1e041d4
y.create.l HWIO_APPS_SMMU_SSD_REG_118_APPS_ADDR A:0x1e041d8
y.create.l HWIO_APPS_SMMU_SSD_REG_119_APPS_ADDR A:0x1e041dc
y.create.l HWIO_APPS_SMMU_SSD_REG_120_APPS_ADDR A:0x1e041e0
y.create.l HWIO_APPS_SMMU_SSD_REG_121_APPS_ADDR A:0x1e041e4
y.create.l HWIO_APPS_SMMU_SSD_REG_122_APPS_ADDR A:0x1e041e8
y.create.l HWIO_APPS_SMMU_SSD_REG_123_APPS_ADDR A:0x1e041ec
y.create.l HWIO_APPS_SMMU_SSD_REG_124_APPS_ADDR A:0x1e041f0
y.create.l HWIO_APPS_SMMU_SSD_REG_125_APPS_ADDR A:0x1e041f4
y.create.l HWIO_APPS_SMMU_SSD_REG_126_APPS_ADDR A:0x1e041f8
y.create.l HWIO_APPS_SMMU_SSD_REG_127_APPS_ADDR A:0x1e041fc
y.create.l HWIO_APPS_SMMU_SSD_REG_128_APPS_ADDR A:0x1e04200
y.create.l HWIO_APPS_SMMU_SSD_REG_129_APPS_ADDR A:0x1e04204
y.create.l HWIO_APPS_SMMU_SSD_REG_130_APPS_ADDR A:0x1e04208
y.create.l HWIO_APPS_SMMU_SSD_REG_131_APPS_ADDR A:0x1e0420c
y.create.l HWIO_APPS_SMMU_SSD_REG_132_APPS_ADDR A:0x1e04210
y.create.l HWIO_APPS_SMMU_SSD_REG_133_APPS_ADDR A:0x1e04214
y.create.l HWIO_APPS_SMMU_SSD_REG_134_APPS_ADDR A:0x1e04218
y.create.l HWIO_APPS_SMMU_SSD_REG_135_APPS_ADDR A:0x1e0421c
y.create.l HWIO_APPS_SMMU_SSD_REG_136_APPS_ADDR A:0x1e04220
y.create.l HWIO_APPS_SMMU_SSD_REG_137_APPS_ADDR A:0x1e04224
y.create.l HWIO_APPS_SMMU_SSD_REG_138_APPS_ADDR A:0x1e04228
y.create.l HWIO_APPS_SMMU_SSD_REG_139_APPS_ADDR A:0x1e0422c
y.create.l HWIO_APPS_SMMU_SSD_REG_140_APPS_ADDR A:0x1e04230
y.create.l HWIO_APPS_SMMU_SSD_REG_141_APPS_ADDR A:0x1e04234
y.create.l HWIO_APPS_SMMU_SSD_REG_142_APPS_ADDR A:0x1e04238
y.create.l HWIO_APPS_SMMU_SSD_REG_143_APPS_ADDR A:0x1e0423c
y.create.l HWIO_APPS_SMMU_SSD_REG_144_APPS_ADDR A:0x1e04240
y.create.l HWIO_APPS_SMMU_SSD_REG_145_APPS_ADDR A:0x1e04244
y.create.l HWIO_APPS_SMMU_SSD_REG_146_APPS_ADDR A:0x1e04248
y.create.l HWIO_APPS_SMMU_SSD_REG_147_APPS_ADDR A:0x1e0424c
y.create.l HWIO_APPS_SMMU_SSD_REG_148_APPS_ADDR A:0x1e04250
y.create.l HWIO_APPS_SMMU_SSD_REG_149_APPS_ADDR A:0x1e04254
y.create.l HWIO_APPS_SMMU_SSD_REG_150_APPS_ADDR A:0x1e04258
y.create.l HWIO_APPS_SMMU_SSD_REG_151_APPS_ADDR A:0x1e0425c
y.create.l HWIO_APPS_SMMU_SSD_REG_152_APPS_ADDR A:0x1e04260
y.create.l HWIO_APPS_SMMU_SSD_REG_153_APPS_ADDR A:0x1e04264
y.create.l HWIO_APPS_SMMU_SSD_REG_154_APPS_ADDR A:0x1e04268
y.create.l HWIO_APPS_SMMU_SSD_REG_155_APPS_ADDR A:0x1e0426c
y.create.l HWIO_APPS_SMMU_SSD_REG_156_APPS_ADDR A:0x1e04270
y.create.l HWIO_APPS_SMMU_SSD_REG_157_APPS_ADDR A:0x1e04274
y.create.l HWIO_APPS_SMMU_SSD_REG_158_APPS_ADDR A:0x1e04278
y.create.l HWIO_APPS_SMMU_SSD_REG_159_APPS_ADDR A:0x1e0427c
y.create.l HWIO_APPS_SMMU_SSD_REG_160_APPS_ADDR A:0x1e04280
y.create.l HWIO_APPS_SMMU_SSD_REG_161_APPS_ADDR A:0x1e04284
y.create.l HWIO_APPS_SMMU_SSD_REG_162_APPS_ADDR A:0x1e04288
y.create.l HWIO_APPS_SMMU_SSD_REG_163_APPS_ADDR A:0x1e0428c
y.create.l HWIO_APPS_SMMU_SSD_REG_164_APPS_ADDR A:0x1e04290
y.create.l HWIO_APPS_SMMU_SSD_REG_165_APPS_ADDR A:0x1e04294
y.create.l HWIO_APPS_SMMU_SSD_REG_166_APPS_ADDR A:0x1e04298
y.create.l HWIO_APPS_SMMU_SSD_REG_167_APPS_ADDR A:0x1e0429c
y.create.l HWIO_APPS_SMMU_SSD_REG_168_APPS_ADDR A:0x1e042a0
y.create.l HWIO_APPS_SMMU_SSD_REG_169_APPS_ADDR A:0x1e042a4
y.create.l HWIO_APPS_SMMU_SSD_REG_170_APPS_ADDR A:0x1e042a8
y.create.l HWIO_APPS_SMMU_SSD_REG_171_APPS_ADDR A:0x1e042ac
y.create.l HWIO_APPS_SMMU_SSD_REG_172_APPS_ADDR A:0x1e042b0
y.create.l HWIO_APPS_SMMU_SSD_REG_173_APPS_ADDR A:0x1e042b4
y.create.l HWIO_APPS_SMMU_SSD_REG_174_APPS_ADDR A:0x1e042b8
y.create.l HWIO_APPS_SMMU_SSD_REG_175_APPS_ADDR A:0x1e042bc
y.create.l HWIO_APPS_SMMU_SSD_REG_176_APPS_ADDR A:0x1e042c0
y.create.l HWIO_APPS_SMMU_SSD_REG_177_APPS_ADDR A:0x1e042c4
y.create.l HWIO_APPS_SMMU_SSD_REG_178_APPS_ADDR A:0x1e042c8
y.create.l HWIO_APPS_SMMU_SSD_REG_179_APPS_ADDR A:0x1e042cc
y.create.l HWIO_APPS_SMMU_SSD_REG_180_APPS_ADDR A:0x1e042d0
y.create.l HWIO_APPS_SMMU_SSD_REG_181_APPS_ADDR A:0x1e042d4
y.create.l HWIO_APPS_SMMU_SSD_REG_182_APPS_ADDR A:0x1e042d8
y.create.l HWIO_APPS_SMMU_SSD_REG_183_APPS_ADDR A:0x1e042dc
y.create.l HWIO_APPS_SMMU_SSD_REG_184_APPS_ADDR A:0x1e042e0
y.create.l HWIO_APPS_SMMU_SSD_REG_185_APPS_ADDR A:0x1e042e4
y.create.l HWIO_APPS_SMMU_SSD_REG_186_APPS_ADDR A:0x1e042e8
y.create.l HWIO_APPS_SMMU_SSD_REG_187_APPS_ADDR A:0x1e042ec
y.create.l HWIO_APPS_SMMU_SSD_REG_188_APPS_ADDR A:0x1e042f0
y.create.l HWIO_APPS_SMMU_SSD_REG_189_APPS_ADDR A:0x1e042f4
y.create.l HWIO_APPS_SMMU_SSD_REG_190_APPS_ADDR A:0x1e042f8
y.create.l HWIO_APPS_SMMU_SSD_REG_191_APPS_ADDR A:0x1e042fc
y.create.l HWIO_APPS_SMMU_SSD_REG_192_APPS_ADDR A:0x1e04300
y.create.l HWIO_APPS_SMMU_SSD_REG_193_APPS_ADDR A:0x1e04304
y.create.l HWIO_APPS_SMMU_SSD_REG_194_APPS_ADDR A:0x1e04308
y.create.l HWIO_APPS_SMMU_SSD_REG_195_APPS_ADDR A:0x1e0430c
y.create.l HWIO_APPS_SMMU_SSD_REG_196_APPS_ADDR A:0x1e04310
y.create.l HWIO_APPS_SMMU_SSD_REG_197_APPS_ADDR A:0x1e04314
y.create.l HWIO_APPS_SMMU_SSD_REG_198_APPS_ADDR A:0x1e04318
y.create.l HWIO_APPS_SMMU_SSD_REG_199_APPS_ADDR A:0x1e0431c
y.create.l HWIO_APPS_SMMU_SSD_REG_200_APPS_ADDR A:0x1e04320
y.create.l HWIO_APPS_SMMU_SSD_REG_201_APPS_ADDR A:0x1e04324
y.create.l HWIO_APPS_SMMU_SSD_REG_202_APPS_ADDR A:0x1e04328
y.create.l HWIO_APPS_SMMU_SSD_REG_203_APPS_ADDR A:0x1e0432c
y.create.l HWIO_APPS_SMMU_SSD_REG_204_APPS_ADDR A:0x1e04330
y.create.l HWIO_APPS_SMMU_SSD_REG_205_APPS_ADDR A:0x1e04334
y.create.l HWIO_APPS_SMMU_SSD_REG_206_APPS_ADDR A:0x1e04338
y.create.l HWIO_APPS_SMMU_SSD_REG_207_APPS_ADDR A:0x1e0433c
y.create.l HWIO_APPS_SMMU_SSD_REG_208_APPS_ADDR A:0x1e04340
y.create.l HWIO_APPS_SMMU_SSD_REG_209_APPS_ADDR A:0x1e04344
y.create.l HWIO_APPS_SMMU_SSD_REG_210_APPS_ADDR A:0x1e04348
y.create.l HWIO_APPS_SMMU_SSD_REG_211_APPS_ADDR A:0x1e0434c
y.create.l HWIO_APPS_SMMU_SSD_REG_212_APPS_ADDR A:0x1e04350
y.create.l HWIO_APPS_SMMU_SSD_REG_213_APPS_ADDR A:0x1e04354
y.create.l HWIO_APPS_SMMU_SSD_REG_214_APPS_ADDR A:0x1e04358
y.create.l HWIO_APPS_SMMU_SSD_REG_215_APPS_ADDR A:0x1e0435c
y.create.l HWIO_APPS_SMMU_SSD_REG_216_APPS_ADDR A:0x1e04360
y.create.l HWIO_APPS_SMMU_SSD_REG_217_APPS_ADDR A:0x1e04364
y.create.l HWIO_APPS_SMMU_SSD_REG_218_APPS_ADDR A:0x1e04368
y.create.l HWIO_APPS_SMMU_SSD_REG_219_APPS_ADDR A:0x1e0436c
y.create.l HWIO_APPS_SMMU_SSD_REG_220_APPS_ADDR A:0x1e04370
y.create.l HWIO_APPS_SMMU_SSD_REG_221_APPS_ADDR A:0x1e04374
y.create.l HWIO_APPS_SMMU_SSD_REG_222_APPS_ADDR A:0x1e04378
y.create.l HWIO_APPS_SMMU_SSD_REG_223_APPS_ADDR A:0x1e0437c
y.create.l HWIO_APPS_SMMU_SSD_REG_224_APPS_ADDR A:0x1e04380
y.create.l HWIO_APPS_SMMU_SSD_REG_225_APPS_ADDR A:0x1e04384
y.create.l HWIO_APPS_SMMU_SSD_REG_226_APPS_ADDR A:0x1e04388
y.create.l HWIO_APPS_SMMU_SSD_REG_227_APPS_ADDR A:0x1e0438c
y.create.l HWIO_APPS_SMMU_SSD_REG_228_APPS_ADDR A:0x1e04390
y.create.l HWIO_APPS_SMMU_SSD_REG_229_APPS_ADDR A:0x1e04394
y.create.l HWIO_APPS_SMMU_SSD_REG_230_APPS_ADDR A:0x1e04398
y.create.l HWIO_APPS_SMMU_SSD_REG_231_APPS_ADDR A:0x1e0439c
y.create.l HWIO_APPS_SMMU_SSD_REG_232_APPS_ADDR A:0x1e043a0
y.create.l HWIO_APPS_SMMU_SSD_REG_233_APPS_ADDR A:0x1e043a4
y.create.l HWIO_APPS_SMMU_SSD_REG_234_APPS_ADDR A:0x1e043a8
y.create.l HWIO_APPS_SMMU_SSD_REG_235_APPS_ADDR A:0x1e043ac
y.create.l HWIO_APPS_SMMU_SSD_REG_236_APPS_ADDR A:0x1e043b0
y.create.l HWIO_APPS_SMMU_SSD_REG_237_APPS_ADDR A:0x1e043b4
y.create.l HWIO_APPS_SMMU_SSD_REG_238_APPS_ADDR A:0x1e043b8
y.create.l HWIO_APPS_SMMU_SSD_REG_239_APPS_ADDR A:0x1e043bc
y.create.l HWIO_APPS_SMMU_SSD_REG_240_APPS_ADDR A:0x1e043c0
y.create.l HWIO_APPS_SMMU_SSD_REG_241_APPS_ADDR A:0x1e043c4
y.create.l HWIO_APPS_SMMU_SSD_REG_242_APPS_ADDR A:0x1e043c8
y.create.l HWIO_APPS_SMMU_SSD_REG_243_APPS_ADDR A:0x1e043cc
y.create.l HWIO_APPS_SMMU_SSD_REG_244_APPS_ADDR A:0x1e043d0
y.create.l HWIO_APPS_SMMU_SSD_REG_245_APPS_ADDR A:0x1e043d4
y.create.l HWIO_APPS_SMMU_SSD_REG_246_APPS_ADDR A:0x1e043d8
y.create.l HWIO_APPS_SMMU_SSD_REG_247_APPS_ADDR A:0x1e043dc
y.create.l HWIO_APPS_SMMU_SSD_REG_248_APPS_ADDR A:0x1e043e0
y.create.l HWIO_APPS_SMMU_SSD_REG_249_APPS_ADDR A:0x1e043e4
y.create.l HWIO_APPS_SMMU_SSD_REG_250_APPS_ADDR A:0x1e043e8
y.create.l HWIO_APPS_SMMU_SSD_REG_251_APPS_ADDR A:0x1e043ec
y.create.l HWIO_APPS_SMMU_SSD_REG_252_APPS_ADDR A:0x1e043f0
y.create.l HWIO_APPS_SMMU_SSD_REG_253_APPS_ADDR A:0x1e043f4
y.create.l HWIO_APPS_SMMU_SSD_REG_254_APPS_ADDR A:0x1e043f8
y.create.l HWIO_APPS_SMMU_SSD_REG_255_APPS_ADDR A:0x1e043fc
y.create.l HWIO_APPS_SMMU_SSD_REG_256_APPS_ADDR A:0x1e04400
y.create.l HWIO_APPS_SMMU_SSD_REG_257_APPS_ADDR A:0x1e04404
y.create.l HWIO_APPS_SMMU_SSD_REG_258_APPS_ADDR A:0x1e04408
y.create.l HWIO_APPS_SMMU_SSD_REG_259_APPS_ADDR A:0x1e0440c
y.create.l HWIO_APPS_SMMU_SSD_REG_260_APPS_ADDR A:0x1e04410
y.create.l HWIO_APPS_SMMU_SSD_REG_261_APPS_ADDR A:0x1e04414
y.create.l HWIO_APPS_SMMU_SSD_REG_262_APPS_ADDR A:0x1e04418
y.create.l HWIO_APPS_SMMU_SSD_REG_263_APPS_ADDR A:0x1e0441c
y.create.l HWIO_APPS_SMMU_SSD_REG_264_APPS_ADDR A:0x1e04420
y.create.l HWIO_APPS_SMMU_SSD_REG_265_APPS_ADDR A:0x1e04424
y.create.l HWIO_APPS_SMMU_SSD_REG_266_APPS_ADDR A:0x1e04428
y.create.l HWIO_APPS_SMMU_SSD_REG_267_APPS_ADDR A:0x1e0442c
y.create.l HWIO_APPS_SMMU_SSD_REG_268_APPS_ADDR A:0x1e04430
y.create.l HWIO_APPS_SMMU_SSD_REG_269_APPS_ADDR A:0x1e04434
y.create.l HWIO_APPS_SMMU_SSD_REG_270_APPS_ADDR A:0x1e04438
y.create.l HWIO_APPS_SMMU_SSD_REG_271_APPS_ADDR A:0x1e0443c
y.create.l HWIO_APPS_SMMU_SSD_REG_272_APPS_ADDR A:0x1e04440
y.create.l HWIO_APPS_SMMU_SSD_REG_273_APPS_ADDR A:0x1e04444
y.create.l HWIO_APPS_SMMU_SSD_REG_274_APPS_ADDR A:0x1e04448
y.create.l HWIO_APPS_SMMU_SSD_REG_275_APPS_ADDR A:0x1e0444c
y.create.l HWIO_APPS_SMMU_SSD_REG_276_APPS_ADDR A:0x1e04450
y.create.l HWIO_APPS_SMMU_SSD_REG_277_APPS_ADDR A:0x1e04454
y.create.l HWIO_APPS_SMMU_SSD_REG_278_APPS_ADDR A:0x1e04458
y.create.l HWIO_APPS_SMMU_SSD_REG_279_APPS_ADDR A:0x1e0445c
y.create.l HWIO_APPS_SMMU_SSD_REG_280_APPS_ADDR A:0x1e04460
y.create.l HWIO_APPS_SMMU_SSD_REG_281_APPS_ADDR A:0x1e04464
y.create.l HWIO_APPS_SMMU_SSD_REG_282_APPS_ADDR A:0x1e04468
y.create.l HWIO_APPS_SMMU_SSD_REG_283_APPS_ADDR A:0x1e0446c
y.create.l HWIO_APPS_SMMU_SSD_REG_284_APPS_ADDR A:0x1e04470
y.create.l HWIO_APPS_SMMU_SSD_REG_285_APPS_ADDR A:0x1e04474
y.create.l HWIO_APPS_SMMU_SSD_REG_286_APPS_ADDR A:0x1e04478
y.create.l HWIO_APPS_SMMU_SSD_REG_287_APPS_ADDR A:0x1e0447c
y.create.l HWIO_APPS_SMMU_SSD_REG_288_APPS_ADDR A:0x1e04480
y.create.l HWIO_APPS_SMMU_SSD_REG_289_APPS_ADDR A:0x1e04484
y.create.l HWIO_APPS_SMMU_SSD_REG_290_APPS_ADDR A:0x1e04488
y.create.l HWIO_APPS_SMMU_SSD_REG_291_APPS_ADDR A:0x1e0448c
y.create.l HWIO_APPS_SMMU_SSD_REG_292_APPS_ADDR A:0x1e04490
y.create.l HWIO_APPS_SMMU_SSD_REG_293_APPS_ADDR A:0x1e04494
y.create.l HWIO_APPS_SMMU_SSD_REG_294_APPS_ADDR A:0x1e04498
y.create.l HWIO_APPS_SMMU_SSD_REG_295_APPS_ADDR A:0x1e0449c
y.create.l HWIO_APPS_SMMU_SSD_REG_296_APPS_ADDR A:0x1e044a0
y.create.l HWIO_APPS_SMMU_SSD_REG_297_APPS_ADDR A:0x1e044a4
y.create.l HWIO_APPS_SMMU_SSD_REG_298_APPS_ADDR A:0x1e044a8
y.create.l HWIO_APPS_SMMU_SSD_REG_299_APPS_ADDR A:0x1e044ac
y.create.l HWIO_APPS_SMMU_SSD_REG_300_APPS_ADDR A:0x1e044b0
y.create.l HWIO_APPS_SMMU_SSD_REG_301_APPS_ADDR A:0x1e044b4
y.create.l HWIO_APPS_SMMU_SSD_REG_302_APPS_ADDR A:0x1e044b8
y.create.l HWIO_APPS_SMMU_SSD_REG_303_APPS_ADDR A:0x1e044bc
y.create.l HWIO_APPS_SMMU_SSD_REG_304_APPS_ADDR A:0x1e044c0
y.create.l HWIO_APPS_SMMU_SSD_REG_305_APPS_ADDR A:0x1e044c4
y.create.l HWIO_APPS_SMMU_SSD_REG_306_APPS_ADDR A:0x1e044c8
y.create.l HWIO_APPS_SMMU_SSD_REG_307_APPS_ADDR A:0x1e044cc
y.create.l HWIO_APPS_SMMU_SSD_REG_308_APPS_ADDR A:0x1e044d0
y.create.l HWIO_APPS_SMMU_SSD_REG_309_APPS_ADDR A:0x1e044d4
y.create.l HWIO_APPS_SMMU_SSD_REG_310_APPS_ADDR A:0x1e044d8
y.create.l HWIO_APPS_SMMU_SSD_REG_311_APPS_ADDR A:0x1e044dc
y.create.l HWIO_APPS_SMMU_SSD_REG_312_APPS_ADDR A:0x1e044e0
y.create.l HWIO_APPS_SMMU_SSD_REG_313_APPS_ADDR A:0x1e044e4
y.create.l HWIO_APPS_SMMU_SSD_REG_314_APPS_ADDR A:0x1e044e8
y.create.l HWIO_APPS_SMMU_SSD_REG_315_APPS_ADDR A:0x1e044ec
y.create.l HWIO_APPS_SMMU_SSD_REG_316_APPS_ADDR A:0x1e044f0
y.create.l HWIO_APPS_SMMU_SSD_REG_317_APPS_ADDR A:0x1e044f4
y.create.l HWIO_APPS_SMMU_SSD_REG_318_APPS_ADDR A:0x1e044f8
y.create.l HWIO_APPS_SMMU_SSD_REG_319_APPS_ADDR A:0x1e044fc
y.create.l HWIO_APPS_SMMU_SSD_REG_320_APPS_ADDR A:0x1e04500
y.create.l HWIO_APPS_SMMU_SSD_REG_321_APPS_ADDR A:0x1e04504
y.create.l HWIO_APPS_SMMU_SSD_REG_322_APPS_ADDR A:0x1e04508
y.create.l HWIO_APPS_SMMU_SSD_REG_323_APPS_ADDR A:0x1e0450c
y.create.l HWIO_APPS_SMMU_SSD_REG_324_APPS_ADDR A:0x1e04510
y.create.l HWIO_APPS_SMMU_SSD_REG_325_APPS_ADDR A:0x1e04514
y.create.l HWIO_APPS_SMMU_SSD_REG_326_APPS_ADDR A:0x1e04518
y.create.l HWIO_APPS_SMMU_SSD_REG_327_APPS_ADDR A:0x1e0451c
y.create.l HWIO_APPS_SMMU_SSD_REG_328_APPS_ADDR A:0x1e04520
y.create.l HWIO_APPS_SMMU_SSD_REG_329_APPS_ADDR A:0x1e04524
y.create.l HWIO_APPS_SMMU_SSD_REG_330_APPS_ADDR A:0x1e04528
y.create.l HWIO_APPS_SMMU_SSD_REG_331_APPS_ADDR A:0x1e0452c
y.create.l HWIO_APPS_SMMU_SSD_REG_332_APPS_ADDR A:0x1e04530
y.create.l HWIO_APPS_SMMU_SSD_REG_333_APPS_ADDR A:0x1e04534
y.create.l HWIO_APPS_SMMU_SSD_REG_334_APPS_ADDR A:0x1e04538
y.create.l HWIO_APPS_SMMU_SSD_REG_335_APPS_ADDR A:0x1e0453c
y.create.l HWIO_APPS_SMMU_SSD_REG_336_APPS_ADDR A:0x1e04540
y.create.l HWIO_APPS_SMMU_SSD_REG_337_APPS_ADDR A:0x1e04544
y.create.l HWIO_APPS_SMMU_SSD_REG_338_APPS_ADDR A:0x1e04548
y.create.l HWIO_APPS_SMMU_SSD_REG_339_APPS_ADDR A:0x1e0454c
y.create.l HWIO_APPS_SMMU_SSD_REG_340_APPS_ADDR A:0x1e04550
y.create.l HWIO_APPS_SMMU_SSD_REG_341_APPS_ADDR A:0x1e04554
y.create.l HWIO_APPS_SMMU_SSD_REG_342_APPS_ADDR A:0x1e04558
y.create.l HWIO_APPS_SMMU_SSD_REG_343_APPS_ADDR A:0x1e0455c
y.create.l HWIO_APPS_SMMU_SSD_REG_344_APPS_ADDR A:0x1e04560
y.create.l HWIO_APPS_SMMU_SSD_REG_345_APPS_ADDR A:0x1e04564
y.create.l HWIO_APPS_SMMU_SSD_REG_346_APPS_ADDR A:0x1e04568
y.create.l HWIO_APPS_SMMU_SSD_REG_347_APPS_ADDR A:0x1e0456c
y.create.l HWIO_APPS_SMMU_SSD_REG_348_APPS_ADDR A:0x1e04570
y.create.l HWIO_APPS_SMMU_SSD_REG_349_APPS_ADDR A:0x1e04574
y.create.l HWIO_APPS_SMMU_SSD_REG_350_APPS_ADDR A:0x1e04578
y.create.l HWIO_APPS_SMMU_SSD_REG_351_APPS_ADDR A:0x1e0457c
y.create.l HWIO_APPS_SMMU_SSD_REG_352_APPS_ADDR A:0x1e04580
y.create.l HWIO_APPS_SMMU_SSD_REG_353_APPS_ADDR A:0x1e04584
y.create.l HWIO_APPS_SMMU_SSD_REG_354_APPS_ADDR A:0x1e04588
y.create.l HWIO_APPS_SMMU_SSD_REG_355_APPS_ADDR A:0x1e0458c
y.create.l HWIO_APPS_SMMU_SSD_REG_356_APPS_ADDR A:0x1e04590
y.create.l HWIO_APPS_SMMU_SSD_REG_357_APPS_ADDR A:0x1e04594
y.create.l HWIO_APPS_SMMU_SSD_REG_358_APPS_ADDR A:0x1e04598
y.create.l HWIO_APPS_SMMU_SSD_REG_359_APPS_ADDR A:0x1e0459c
y.create.l HWIO_APPS_SMMU_SSD_REG_360_APPS_ADDR A:0x1e045a0
y.create.l HWIO_APPS_SMMU_SSD_REG_361_APPS_ADDR A:0x1e045a4
y.create.l HWIO_APPS_SMMU_SSD_REG_362_APPS_ADDR A:0x1e045a8
y.create.l HWIO_APPS_SMMU_SSD_REG_363_APPS_ADDR A:0x1e045ac
y.create.l HWIO_APPS_SMMU_SSD_REG_364_APPS_ADDR A:0x1e045b0
y.create.l HWIO_APPS_SMMU_SSD_REG_365_APPS_ADDR A:0x1e045b4
y.create.l HWIO_APPS_SMMU_SSD_REG_366_APPS_ADDR A:0x1e045b8
y.create.l HWIO_APPS_SMMU_SSD_REG_367_APPS_ADDR A:0x1e045bc
y.create.l HWIO_APPS_SMMU_SSD_REG_368_APPS_ADDR A:0x1e045c0
y.create.l HWIO_APPS_SMMU_SSD_REG_369_APPS_ADDR A:0x1e045c4
y.create.l HWIO_APPS_SMMU_SSD_REG_370_APPS_ADDR A:0x1e045c8
y.create.l HWIO_APPS_SMMU_SSD_REG_371_APPS_ADDR A:0x1e045cc
y.create.l HWIO_APPS_SMMU_SSD_REG_372_APPS_ADDR A:0x1e045d0
y.create.l HWIO_APPS_SMMU_SSD_REG_373_APPS_ADDR A:0x1e045d4
y.create.l HWIO_APPS_SMMU_SSD_REG_374_APPS_ADDR A:0x1e045d8
y.create.l HWIO_APPS_SMMU_SSD_REG_375_APPS_ADDR A:0x1e045dc
y.create.l HWIO_APPS_SMMU_SSD_REG_376_APPS_ADDR A:0x1e045e0
y.create.l HWIO_APPS_SMMU_SSD_REG_377_APPS_ADDR A:0x1e045e4
y.create.l HWIO_APPS_SMMU_SSD_REG_378_APPS_ADDR A:0x1e045e8
y.create.l HWIO_APPS_SMMU_SSD_REG_379_APPS_ADDR A:0x1e045ec
y.create.l HWIO_APPS_SMMU_SSD_REG_380_APPS_ADDR A:0x1e045f0
y.create.l HWIO_APPS_SMMU_SSD_REG_381_APPS_ADDR A:0x1e045f4
y.create.l HWIO_APPS_SMMU_SSD_REG_382_APPS_ADDR A:0x1e045f8
y.create.l HWIO_APPS_SMMU_SSD_REG_383_APPS_ADDR A:0x1e045fc
y.create.l HWIO_APPS_SMMU_SSD_REG_384_APPS_ADDR A:0x1e04600
y.create.l HWIO_APPS_SMMU_SSD_REG_385_APPS_ADDR A:0x1e04604
y.create.l HWIO_APPS_SMMU_SSD_REG_386_APPS_ADDR A:0x1e04608
y.create.l HWIO_APPS_SMMU_SSD_REG_387_APPS_ADDR A:0x1e0460c
y.create.l HWIO_APPS_SMMU_SSD_REG_388_APPS_ADDR A:0x1e04610
y.create.l HWIO_APPS_SMMU_SSD_REG_389_APPS_ADDR A:0x1e04614
y.create.l HWIO_APPS_SMMU_SSD_REG_390_APPS_ADDR A:0x1e04618
y.create.l HWIO_APPS_SMMU_SSD_REG_391_APPS_ADDR A:0x1e0461c
y.create.l HWIO_APPS_SMMU_SSD_REG_392_APPS_ADDR A:0x1e04620
y.create.l HWIO_APPS_SMMU_SSD_REG_393_APPS_ADDR A:0x1e04624
y.create.l HWIO_APPS_SMMU_SSD_REG_394_APPS_ADDR A:0x1e04628
y.create.l HWIO_APPS_SMMU_SSD_REG_395_APPS_ADDR A:0x1e0462c
y.create.l HWIO_APPS_SMMU_SSD_REG_396_APPS_ADDR A:0x1e04630
y.create.l HWIO_APPS_SMMU_SSD_REG_397_APPS_ADDR A:0x1e04634
y.create.l HWIO_APPS_SMMU_SSD_REG_398_APPS_ADDR A:0x1e04638
y.create.l HWIO_APPS_SMMU_SSD_REG_399_APPS_ADDR A:0x1e0463c
y.create.l HWIO_APPS_SMMU_SSD_REG_400_APPS_ADDR A:0x1e04640
y.create.l HWIO_APPS_SMMU_SSD_REG_401_APPS_ADDR A:0x1e04644
y.create.l HWIO_APPS_SMMU_SSD_REG_402_APPS_ADDR A:0x1e04648
y.create.l HWIO_APPS_SMMU_SSD_REG_403_APPS_ADDR A:0x1e0464c
y.create.l HWIO_APPS_SMMU_SSD_REG_404_APPS_ADDR A:0x1e04650
y.create.l HWIO_APPS_SMMU_SSD_REG_405_APPS_ADDR A:0x1e04654
y.create.l HWIO_APPS_SMMU_SSD_REG_406_APPS_ADDR A:0x1e04658
y.create.l HWIO_APPS_SMMU_SSD_REG_407_APPS_ADDR A:0x1e0465c
y.create.l HWIO_APPS_SMMU_SSD_REG_408_APPS_ADDR A:0x1e04660
y.create.l HWIO_APPS_SMMU_SSD_REG_409_APPS_ADDR A:0x1e04664
y.create.l HWIO_APPS_SMMU_SSD_REG_410_APPS_ADDR A:0x1e04668
y.create.l HWIO_APPS_SMMU_SSD_REG_411_APPS_ADDR A:0x1e0466c
y.create.l HWIO_APPS_SMMU_SSD_REG_412_APPS_ADDR A:0x1e04670
y.create.l HWIO_APPS_SMMU_SSD_REG_413_APPS_ADDR A:0x1e04674
y.create.l HWIO_APPS_SMMU_SSD_REG_414_APPS_ADDR A:0x1e04678
y.create.l HWIO_APPS_SMMU_SSD_REG_415_APPS_ADDR A:0x1e0467c
y.create.l HWIO_APPS_SMMU_SSD_REG_416_APPS_ADDR A:0x1e04680
y.create.l HWIO_APPS_SMMU_SSD_REG_417_APPS_ADDR A:0x1e04684
y.create.l HWIO_APPS_SMMU_SSD_REG_418_APPS_ADDR A:0x1e04688
y.create.l HWIO_APPS_SMMU_SSD_REG_419_APPS_ADDR A:0x1e0468c
y.create.l HWIO_APPS_SMMU_SSD_REG_420_APPS_ADDR A:0x1e04690
y.create.l HWIO_APPS_SMMU_SSD_REG_421_APPS_ADDR A:0x1e04694
y.create.l HWIO_APPS_SMMU_SSD_REG_422_APPS_ADDR A:0x1e04698
y.create.l HWIO_APPS_SMMU_SSD_REG_423_APPS_ADDR A:0x1e0469c
y.create.l HWIO_APPS_SMMU_SSD_REG_424_APPS_ADDR A:0x1e046a0
y.create.l HWIO_APPS_SMMU_SSD_REG_425_APPS_ADDR A:0x1e046a4
y.create.l HWIO_APPS_SMMU_SSD_REG_426_APPS_ADDR A:0x1e046a8
y.create.l HWIO_APPS_SMMU_SSD_REG_427_APPS_ADDR A:0x1e046ac
y.create.l HWIO_APPS_SMMU_SSD_REG_428_APPS_ADDR A:0x1e046b0
y.create.l HWIO_APPS_SMMU_SSD_REG_429_APPS_ADDR A:0x1e046b4
y.create.l HWIO_APPS_SMMU_SSD_REG_430_APPS_ADDR A:0x1e046b8
y.create.l HWIO_APPS_SMMU_SSD_REG_431_APPS_ADDR A:0x1e046bc
y.create.l HWIO_APPS_SMMU_SSD_REG_432_APPS_ADDR A:0x1e046c0
y.create.l HWIO_APPS_SMMU_SSD_REG_433_APPS_ADDR A:0x1e046c4
y.create.l HWIO_APPS_SMMU_SSD_REG_434_APPS_ADDR A:0x1e046c8
y.create.l HWIO_APPS_SMMU_SSD_REG_435_APPS_ADDR A:0x1e046cc
y.create.l HWIO_APPS_SMMU_SSD_REG_436_APPS_ADDR A:0x1e046d0
y.create.l HWIO_APPS_SMMU_SSD_REG_437_APPS_ADDR A:0x1e046d4
y.create.l HWIO_APPS_SMMU_SSD_REG_438_APPS_ADDR A:0x1e046d8
y.create.l HWIO_APPS_SMMU_SSD_REG_439_APPS_ADDR A:0x1e046dc
y.create.l HWIO_APPS_SMMU_SSD_REG_440_APPS_ADDR A:0x1e046e0
y.create.l HWIO_APPS_SMMU_SSD_REG_441_APPS_ADDR A:0x1e046e4
y.create.l HWIO_APPS_SMMU_SSD_REG_442_APPS_ADDR A:0x1e046e8
y.create.l HWIO_APPS_SMMU_SSD_REG_443_APPS_ADDR A:0x1e046ec
y.create.l HWIO_APPS_SMMU_SSD_REG_444_APPS_ADDR A:0x1e046f0
y.create.l HWIO_APPS_SMMU_SSD_REG_445_APPS_ADDR A:0x1e046f4
y.create.l HWIO_APPS_SMMU_SSD_REG_446_APPS_ADDR A:0x1e046f8
y.create.l HWIO_APPS_SMMU_SSD_REG_447_APPS_ADDR A:0x1e046fc
y.create.l HWIO_APPS_SMMU_SSD_REG_448_APPS_ADDR A:0x1e04700
y.create.l HWIO_APPS_SMMU_SSD_REG_449_APPS_ADDR A:0x1e04704
y.create.l HWIO_APPS_SMMU_SSD_REG_450_APPS_ADDR A:0x1e04708
y.create.l HWIO_APPS_SMMU_SSD_REG_451_APPS_ADDR A:0x1e0470c
y.create.l HWIO_APPS_SMMU_SSD_REG_452_APPS_ADDR A:0x1e04710
y.create.l HWIO_APPS_SMMU_SSD_REG_453_APPS_ADDR A:0x1e04714
y.create.l HWIO_APPS_SMMU_SSD_REG_454_APPS_ADDR A:0x1e04718
y.create.l HWIO_APPS_SMMU_SSD_REG_455_APPS_ADDR A:0x1e0471c
y.create.l HWIO_APPS_SMMU_SSD_REG_456_APPS_ADDR A:0x1e04720
y.create.l HWIO_APPS_SMMU_SSD_REG_457_APPS_ADDR A:0x1e04724
y.create.l HWIO_APPS_SMMU_SSD_REG_458_APPS_ADDR A:0x1e04728
y.create.l HWIO_APPS_SMMU_SSD_REG_459_APPS_ADDR A:0x1e0472c
y.create.l HWIO_APPS_SMMU_SSD_REG_460_APPS_ADDR A:0x1e04730
y.create.l HWIO_APPS_SMMU_SSD_REG_461_APPS_ADDR A:0x1e04734
y.create.l HWIO_APPS_SMMU_SSD_REG_462_APPS_ADDR A:0x1e04738
y.create.l HWIO_APPS_SMMU_SSD_REG_463_APPS_ADDR A:0x1e0473c
y.create.l HWIO_APPS_SMMU_SSD_REG_464_APPS_ADDR A:0x1e04740
y.create.l HWIO_APPS_SMMU_SSD_REG_465_APPS_ADDR A:0x1e04744
y.create.l HWIO_APPS_SMMU_SSD_REG_466_APPS_ADDR A:0x1e04748
y.create.l HWIO_APPS_SMMU_SSD_REG_467_APPS_ADDR A:0x1e0474c
y.create.l HWIO_APPS_SMMU_SSD_REG_468_APPS_ADDR A:0x1e04750
y.create.l HWIO_APPS_SMMU_SSD_REG_469_APPS_ADDR A:0x1e04754
y.create.l HWIO_APPS_SMMU_SSD_REG_470_APPS_ADDR A:0x1e04758
y.create.l HWIO_APPS_SMMU_SSD_REG_471_APPS_ADDR A:0x1e0475c
y.create.l HWIO_APPS_SMMU_SSD_REG_472_APPS_ADDR A:0x1e04760
y.create.l HWIO_APPS_SMMU_SSD_REG_473_APPS_ADDR A:0x1e04764
y.create.l HWIO_APPS_SMMU_SSD_REG_474_APPS_ADDR A:0x1e04768
y.create.l HWIO_APPS_SMMU_SSD_REG_475_APPS_ADDR A:0x1e0476c
y.create.l HWIO_APPS_SMMU_SSD_REG_476_APPS_ADDR A:0x1e04770
y.create.l HWIO_APPS_SMMU_SSD_REG_477_APPS_ADDR A:0x1e04774
y.create.l HWIO_APPS_SMMU_SSD_REG_478_APPS_ADDR A:0x1e04778
y.create.l HWIO_APPS_SMMU_SSD_REG_479_APPS_ADDR A:0x1e0477c
y.create.l HWIO_APPS_SMMU_SSD_REG_480_APPS_ADDR A:0x1e04780
y.create.l HWIO_APPS_SMMU_SSD_REG_481_APPS_ADDR A:0x1e04784
y.create.l HWIO_APPS_SMMU_SSD_REG_482_APPS_ADDR A:0x1e04788
y.create.l HWIO_APPS_SMMU_SSD_REG_483_APPS_ADDR A:0x1e0478c
y.create.l HWIO_APPS_SMMU_SSD_REG_484_APPS_ADDR A:0x1e04790
y.create.l HWIO_APPS_SMMU_SSD_REG_485_APPS_ADDR A:0x1e04794
y.create.l HWIO_APPS_SMMU_SSD_REG_486_APPS_ADDR A:0x1e04798
y.create.l HWIO_APPS_SMMU_SSD_REG_487_APPS_ADDR A:0x1e0479c
y.create.l HWIO_APPS_SMMU_SSD_REG_488_APPS_ADDR A:0x1e047a0
y.create.l HWIO_APPS_SMMU_SSD_REG_489_APPS_ADDR A:0x1e047a4
y.create.l HWIO_APPS_SMMU_SSD_REG_490_APPS_ADDR A:0x1e047a8
y.create.l HWIO_APPS_SMMU_SSD_REG_491_APPS_ADDR A:0x1e047ac
y.create.l HWIO_APPS_SMMU_SSD_REG_492_APPS_ADDR A:0x1e047b0
y.create.l HWIO_APPS_SMMU_SSD_REG_493_APPS_ADDR A:0x1e047b4
y.create.l HWIO_APPS_SMMU_SSD_REG_494_APPS_ADDR A:0x1e047b8
y.create.l HWIO_APPS_SMMU_SSD_REG_495_APPS_ADDR A:0x1e047bc
y.create.l HWIO_APPS_SMMU_SSD_REG_496_APPS_ADDR A:0x1e047c0
y.create.l HWIO_APPS_SMMU_SSD_REG_497_APPS_ADDR A:0x1e047c4
y.create.l HWIO_APPS_SMMU_SSD_REG_498_APPS_ADDR A:0x1e047c8
y.create.l HWIO_APPS_SMMU_SSD_REG_499_APPS_ADDR A:0x1e047cc
y.create.l HWIO_APPS_SMMU_SSD_REG_500_APPS_ADDR A:0x1e047d0
y.create.l HWIO_APPS_SMMU_SSD_REG_501_APPS_ADDR A:0x1e047d4
y.create.l HWIO_APPS_SMMU_SSD_REG_502_APPS_ADDR A:0x1e047d8
y.create.l HWIO_APPS_SMMU_SSD_REG_503_APPS_ADDR A:0x1e047dc
y.create.l HWIO_APPS_SMMU_SSD_REG_504_APPS_ADDR A:0x1e047e0
y.create.l HWIO_APPS_SMMU_SSD_REG_505_APPS_ADDR A:0x1e047e4
y.create.l HWIO_APPS_SMMU_SSD_REG_506_APPS_ADDR A:0x1e047e8
y.create.l HWIO_APPS_SMMU_SSD_REG_507_APPS_ADDR A:0x1e047ec
y.create.l HWIO_APPS_SMMU_SSD_REG_508_APPS_ADDR A:0x1e047f0
y.create.l HWIO_APPS_SMMU_SSD_REG_509_APPS_ADDR A:0x1e047f4
y.create.l HWIO_APPS_SMMU_SSD_REG_510_APPS_ADDR A:0x1e047f8
y.create.l HWIO_APPS_SMMU_SSD_REG_511_APPS_ADDR A:0x1e047fc
y.create.l HWIO_APPS_SMMU_SSD_REG_512_APPS_ADDR A:0x1e04800
y.create.l HWIO_APPS_SMMU_SSD_REG_513_APPS_ADDR A:0x1e04804
y.create.l HWIO_APPS_SMMU_SSD_REG_514_APPS_ADDR A:0x1e04808
y.create.l HWIO_APPS_SMMU_SSD_REG_515_APPS_ADDR A:0x1e0480c
y.create.l HWIO_APPS_SMMU_SSD_REG_516_APPS_ADDR A:0x1e04810
y.create.l HWIO_APPS_SMMU_SSD_REG_517_APPS_ADDR A:0x1e04814
y.create.l HWIO_APPS_SMMU_SSD_REG_518_APPS_ADDR A:0x1e04818
y.create.l HWIO_APPS_SMMU_SSD_REG_519_APPS_ADDR A:0x1e0481c
y.create.l HWIO_APPS_SMMU_SSD_REG_520_APPS_ADDR A:0x1e04820
y.create.l HWIO_APPS_SMMU_SSD_REG_521_APPS_ADDR A:0x1e04824
y.create.l HWIO_APPS_SMMU_SSD_REG_522_APPS_ADDR A:0x1e04828
y.create.l HWIO_APPS_SMMU_SSD_REG_523_APPS_ADDR A:0x1e0482c
y.create.l HWIO_APPS_SMMU_SSD_REG_524_APPS_ADDR A:0x1e04830
y.create.l HWIO_APPS_SMMU_SSD_REG_525_APPS_ADDR A:0x1e04834
y.create.l HWIO_APPS_SMMU_SSD_REG_526_APPS_ADDR A:0x1e04838
y.create.l HWIO_APPS_SMMU_SSD_REG_527_APPS_ADDR A:0x1e0483c
y.create.l HWIO_APPS_SMMU_SSD_REG_528_APPS_ADDR A:0x1e04840
y.create.l HWIO_APPS_SMMU_SSD_REG_529_APPS_ADDR A:0x1e04844
y.create.l HWIO_APPS_SMMU_SSD_REG_530_APPS_ADDR A:0x1e04848
y.create.l HWIO_APPS_SMMU_SSD_REG_531_APPS_ADDR A:0x1e0484c
y.create.l HWIO_APPS_SMMU_SSD_REG_532_APPS_ADDR A:0x1e04850
y.create.l HWIO_APPS_SMMU_SSD_REG_533_APPS_ADDR A:0x1e04854
y.create.l HWIO_APPS_SMMU_SSD_REG_534_APPS_ADDR A:0x1e04858
y.create.l HWIO_APPS_SMMU_SSD_REG_535_APPS_ADDR A:0x1e0485c
y.create.l HWIO_APPS_SMMU_SSD_REG_536_APPS_ADDR A:0x1e04860
y.create.l HWIO_APPS_SMMU_SSD_REG_537_APPS_ADDR A:0x1e04864
y.create.l HWIO_APPS_SMMU_SSD_REG_538_APPS_ADDR A:0x1e04868
y.create.l HWIO_APPS_SMMU_SSD_REG_539_APPS_ADDR A:0x1e0486c
y.create.l HWIO_APPS_SMMU_SSD_REG_540_APPS_ADDR A:0x1e04870
y.create.l HWIO_APPS_SMMU_SSD_REG_541_APPS_ADDR A:0x1e04874
y.create.l HWIO_APPS_SMMU_SSD_REG_542_APPS_ADDR A:0x1e04878
y.create.l HWIO_APPS_SMMU_SSD_REG_543_APPS_ADDR A:0x1e0487c
y.create.l HWIO_APPS_SMMU_SSD_REG_544_APPS_ADDR A:0x1e04880
y.create.l HWIO_APPS_SMMU_SSD_REG_545_APPS_ADDR A:0x1e04884
y.create.l HWIO_APPS_SMMU_SSD_REG_546_APPS_ADDR A:0x1e04888
y.create.l HWIO_APPS_SMMU_SSD_REG_547_APPS_ADDR A:0x1e0488c
y.create.l HWIO_APPS_SMMU_SSD_REG_548_APPS_ADDR A:0x1e04890
y.create.l HWIO_APPS_SMMU_SSD_REG_549_APPS_ADDR A:0x1e04894
y.create.l HWIO_APPS_SMMU_SSD_REG_550_APPS_ADDR A:0x1e04898
y.create.l HWIO_APPS_SMMU_SSD_REG_551_APPS_ADDR A:0x1e0489c
y.create.l HWIO_APPS_SMMU_SSD_REG_552_APPS_ADDR A:0x1e048a0
y.create.l HWIO_APPS_SMMU_SSD_REG_553_APPS_ADDR A:0x1e048a4
y.create.l HWIO_APPS_SMMU_SSD_REG_554_APPS_ADDR A:0x1e048a8
y.create.l HWIO_APPS_SMMU_SSD_REG_555_APPS_ADDR A:0x1e048ac
y.create.l HWIO_APPS_SMMU_SSD_REG_556_APPS_ADDR A:0x1e048b0
y.create.l HWIO_APPS_SMMU_SSD_REG_557_APPS_ADDR A:0x1e048b4
y.create.l HWIO_APPS_SMMU_SSD_REG_558_APPS_ADDR A:0x1e048b8
y.create.l HWIO_APPS_SMMU_SSD_REG_559_APPS_ADDR A:0x1e048bc
y.create.l HWIO_APPS_SMMU_SSD_REG_560_APPS_ADDR A:0x1e048c0
y.create.l HWIO_APPS_SMMU_SSD_REG_561_APPS_ADDR A:0x1e048c4
y.create.l HWIO_APPS_SMMU_SSD_REG_562_APPS_ADDR A:0x1e048c8
y.create.l HWIO_APPS_SMMU_SSD_REG_563_APPS_ADDR A:0x1e048cc
y.create.l HWIO_APPS_SMMU_SSD_REG_564_APPS_ADDR A:0x1e048d0
y.create.l HWIO_APPS_SMMU_SSD_REG_565_APPS_ADDR A:0x1e048d4
y.create.l HWIO_APPS_SMMU_SSD_REG_566_APPS_ADDR A:0x1e048d8
y.create.l HWIO_APPS_SMMU_SSD_REG_567_APPS_ADDR A:0x1e048dc
y.create.l HWIO_APPS_SMMU_SSD_REG_568_APPS_ADDR A:0x1e048e0
y.create.l HWIO_APPS_SMMU_SSD_REG_569_APPS_ADDR A:0x1e048e4
y.create.l HWIO_APPS_SMMU_SSD_REG_570_APPS_ADDR A:0x1e048e8
y.create.l HWIO_APPS_SMMU_SSD_REG_571_APPS_ADDR A:0x1e048ec
y.create.l HWIO_APPS_SMMU_SSD_REG_572_APPS_ADDR A:0x1e048f0
y.create.l HWIO_APPS_SMMU_SSD_REG_573_APPS_ADDR A:0x1e048f4
y.create.l HWIO_APPS_SMMU_SSD_REG_574_APPS_ADDR A:0x1e048f8
y.create.l HWIO_APPS_SMMU_SSD_REG_575_APPS_ADDR A:0x1e048fc
y.create.l HWIO_APPS_SMMU_SSD_REG_576_APPS_ADDR A:0x1e04900
y.create.l HWIO_APPS_SMMU_SSD_REG_577_APPS_ADDR A:0x1e04904
y.create.l HWIO_APPS_SMMU_SSD_REG_578_APPS_ADDR A:0x1e04908
y.create.l HWIO_APPS_SMMU_SSD_REG_579_APPS_ADDR A:0x1e0490c
y.create.l HWIO_APPS_SMMU_SSD_REG_580_APPS_ADDR A:0x1e04910
y.create.l HWIO_APPS_SMMU_SSD_REG_581_APPS_ADDR A:0x1e04914
y.create.l HWIO_APPS_SMMU_SSD_REG_582_APPS_ADDR A:0x1e04918
y.create.l HWIO_APPS_SMMU_SSD_REG_583_APPS_ADDR A:0x1e0491c
y.create.l HWIO_APPS_SMMU_SSD_REG_584_APPS_ADDR A:0x1e04920
y.create.l HWIO_APPS_SMMU_SSD_REG_585_APPS_ADDR A:0x1e04924
y.create.l HWIO_APPS_SMMU_SSD_REG_586_APPS_ADDR A:0x1e04928
y.create.l HWIO_APPS_SMMU_SSD_REG_587_APPS_ADDR A:0x1e0492c
y.create.l HWIO_APPS_SMMU_SSD_REG_588_APPS_ADDR A:0x1e04930
y.create.l HWIO_APPS_SMMU_SSD_REG_589_APPS_ADDR A:0x1e04934
y.create.l HWIO_APPS_SMMU_SSD_REG_590_APPS_ADDR A:0x1e04938
y.create.l HWIO_APPS_SMMU_SSD_REG_591_APPS_ADDR A:0x1e0493c
y.create.l HWIO_APPS_SMMU_SSD_REG_592_APPS_ADDR A:0x1e04940
y.create.l HWIO_APPS_SMMU_SSD_REG_593_APPS_ADDR A:0x1e04944
y.create.l HWIO_APPS_SMMU_SSD_REG_594_APPS_ADDR A:0x1e04948
y.create.l HWIO_APPS_SMMU_SSD_REG_595_APPS_ADDR A:0x1e0494c
y.create.l HWIO_APPS_SMMU_SSD_REG_596_APPS_ADDR A:0x1e04950
y.create.l HWIO_APPS_SMMU_SSD_REG_597_APPS_ADDR A:0x1e04954
y.create.l HWIO_APPS_SMMU_SSD_REG_598_APPS_ADDR A:0x1e04958
y.create.l HWIO_APPS_SMMU_SSD_REG_599_APPS_ADDR A:0x1e0495c
y.create.l HWIO_APPS_SMMU_SSD_REG_600_APPS_ADDR A:0x1e04960
y.create.l HWIO_APPS_SMMU_SSD_REG_601_APPS_ADDR A:0x1e04964
y.create.l HWIO_APPS_SMMU_SSD_REG_602_APPS_ADDR A:0x1e04968
y.create.l HWIO_APPS_SMMU_SSD_REG_603_APPS_ADDR A:0x1e0496c
y.create.l HWIO_APPS_SMMU_SSD_REG_604_APPS_ADDR A:0x1e04970
y.create.l HWIO_APPS_SMMU_SSD_REG_605_APPS_ADDR A:0x1e04974
y.create.l HWIO_APPS_SMMU_SSD_REG_606_APPS_ADDR A:0x1e04978
y.create.l HWIO_APPS_SMMU_SSD_REG_607_APPS_ADDR A:0x1e0497c
y.create.l HWIO_APPS_SMMU_SSD_REG_608_APPS_ADDR A:0x1e04980
y.create.l HWIO_APPS_SMMU_SSD_REG_609_APPS_ADDR A:0x1e04984
y.create.l HWIO_APPS_SMMU_SSD_REG_610_APPS_ADDR A:0x1e04988
y.create.l HWIO_APPS_SMMU_SSD_REG_611_APPS_ADDR A:0x1e0498c
y.create.l HWIO_APPS_SMMU_SSD_REG_612_APPS_ADDR A:0x1e04990
y.create.l HWIO_APPS_SMMU_SSD_REG_613_APPS_ADDR A:0x1e04994
y.create.l HWIO_APPS_SMMU_SSD_REG_614_APPS_ADDR A:0x1e04998
y.create.l HWIO_APPS_SMMU_SSD_REG_615_APPS_ADDR A:0x1e0499c
y.create.l HWIO_APPS_SMMU_SSD_REG_616_APPS_ADDR A:0x1e049a0
y.create.l HWIO_APPS_SMMU_SSD_REG_617_APPS_ADDR A:0x1e049a4
y.create.l HWIO_APPS_SMMU_SSD_REG_618_APPS_ADDR A:0x1e049a8
y.create.l HWIO_APPS_SMMU_SSD_REG_619_APPS_ADDR A:0x1e049ac
y.create.l HWIO_APPS_SMMU_SSD_REG_620_APPS_ADDR A:0x1e049b0
y.create.l HWIO_APPS_SMMU_SSD_REG_621_APPS_ADDR A:0x1e049b4
y.create.l HWIO_APPS_SMMU_SSD_REG_622_APPS_ADDR A:0x1e049b8
y.create.l HWIO_APPS_SMMU_SSD_REG_623_APPS_ADDR A:0x1e049bc
y.create.l HWIO_APPS_SMMU_SSD_REG_624_APPS_ADDR A:0x1e049c0
y.create.l HWIO_APPS_SMMU_SSD_REG_625_APPS_ADDR A:0x1e049c4
y.create.l HWIO_APPS_SMMU_SSD_REG_626_APPS_ADDR A:0x1e049c8
y.create.l HWIO_APPS_SMMU_SSD_REG_627_APPS_ADDR A:0x1e049cc
y.create.l HWIO_APPS_SMMU_SSD_REG_628_APPS_ADDR A:0x1e049d0
y.create.l HWIO_APPS_SMMU_SSD_REG_629_APPS_ADDR A:0x1e049d4
y.create.l HWIO_APPS_SMMU_SSD_REG_630_APPS_ADDR A:0x1e049d8
y.create.l HWIO_APPS_SMMU_SSD_REG_631_APPS_ADDR A:0x1e049dc
y.create.l HWIO_APPS_SMMU_SSD_REG_632_APPS_ADDR A:0x1e049e0
y.create.l HWIO_APPS_SMMU_SSD_REG_633_APPS_ADDR A:0x1e049e4
y.create.l HWIO_APPS_SMMU_SSD_REG_634_APPS_ADDR A:0x1e049e8
y.create.l HWIO_APPS_SMMU_SSD_REG_635_APPS_ADDR A:0x1e049ec
y.create.l HWIO_APPS_SMMU_SSD_REG_636_APPS_ADDR A:0x1e049f0
y.create.l HWIO_APPS_SMMU_SSD_REG_637_APPS_ADDR A:0x1e049f4
y.create.l HWIO_APPS_SMMU_SSD_REG_638_APPS_ADDR A:0x1e049f8
y.create.l HWIO_APPS_SMMU_SSD_REG_639_APPS_ADDR A:0x1e049fc
y.create.l HWIO_APPS_SMMU_SSD_REG_640_APPS_ADDR A:0x1e04a00
y.create.l HWIO_APPS_SMMU_SSD_REG_641_APPS_ADDR A:0x1e04a04
y.create.l HWIO_APPS_SMMU_SSD_REG_642_APPS_ADDR A:0x1e04a08
y.create.l HWIO_APPS_SMMU_SSD_REG_643_APPS_ADDR A:0x1e04a0c
y.create.l HWIO_APPS_SMMU_SSD_REG_644_APPS_ADDR A:0x1e04a10
y.create.l HWIO_APPS_SMMU_SSD_REG_645_APPS_ADDR A:0x1e04a14
y.create.l HWIO_APPS_SMMU_SSD_REG_646_APPS_ADDR A:0x1e04a18
y.create.l HWIO_APPS_SMMU_SSD_REG_647_APPS_ADDR A:0x1e04a1c
y.create.l HWIO_APPS_SMMU_SSD_REG_648_APPS_ADDR A:0x1e04a20
y.create.l HWIO_APPS_SMMU_SSD_REG_649_APPS_ADDR A:0x1e04a24
y.create.l HWIO_APPS_SMMU_SSD_REG_650_APPS_ADDR A:0x1e04a28
y.create.l HWIO_APPS_SMMU_SSD_REG_651_APPS_ADDR A:0x1e04a2c
y.create.l HWIO_APPS_SMMU_SSD_REG_652_APPS_ADDR A:0x1e04a30
y.create.l HWIO_APPS_SMMU_SSD_REG_653_APPS_ADDR A:0x1e04a34
y.create.l HWIO_APPS_SMMU_SSD_REG_654_APPS_ADDR A:0x1e04a38
y.create.l HWIO_APPS_SMMU_SSD_REG_655_APPS_ADDR A:0x1e04a3c
y.create.l HWIO_APPS_SMMU_SSD_REG_656_APPS_ADDR A:0x1e04a40
y.create.l HWIO_APPS_SMMU_SSD_REG_657_APPS_ADDR A:0x1e04a44
y.create.l HWIO_APPS_SMMU_SSD_REG_658_APPS_ADDR A:0x1e04a48
y.create.l HWIO_APPS_SMMU_SSD_REG_659_APPS_ADDR A:0x1e04a4c
y.create.l HWIO_APPS_SMMU_SSD_REG_660_APPS_ADDR A:0x1e04a50
y.create.l HWIO_APPS_SMMU_SSD_REG_661_APPS_ADDR A:0x1e04a54
y.create.l HWIO_APPS_SMMU_SSD_REG_662_APPS_ADDR A:0x1e04a58
y.create.l HWIO_APPS_SMMU_SSD_REG_663_APPS_ADDR A:0x1e04a5c
y.create.l HWIO_APPS_SMMU_SSD_REG_664_APPS_ADDR A:0x1e04a60
y.create.l HWIO_APPS_SMMU_SSD_REG_665_APPS_ADDR A:0x1e04a64
y.create.l HWIO_APPS_SMMU_SSD_REG_666_APPS_ADDR A:0x1e04a68
y.create.l HWIO_APPS_SMMU_SSD_REG_667_APPS_ADDR A:0x1e04a6c
y.create.l HWIO_APPS_SMMU_SSD_REG_668_APPS_ADDR A:0x1e04a70
y.create.l HWIO_APPS_SMMU_SSD_REG_669_APPS_ADDR A:0x1e04a74
y.create.l HWIO_APPS_SMMU_SSD_REG_670_APPS_ADDR A:0x1e04a78
y.create.l HWIO_APPS_SMMU_SSD_REG_671_APPS_ADDR A:0x1e04a7c
y.create.l HWIO_APPS_SMMU_SSD_REG_672_APPS_ADDR A:0x1e04a80
y.create.l HWIO_APPS_SMMU_SSD_REG_673_APPS_ADDR A:0x1e04a84
y.create.l HWIO_APPS_SMMU_SSD_REG_674_APPS_ADDR A:0x1e04a88
y.create.l HWIO_APPS_SMMU_SSD_REG_675_APPS_ADDR A:0x1e04a8c
y.create.l HWIO_APPS_SMMU_SSD_REG_676_APPS_ADDR A:0x1e04a90
y.create.l HWIO_APPS_SMMU_SSD_REG_677_APPS_ADDR A:0x1e04a94
y.create.l HWIO_APPS_SMMU_SSD_REG_678_APPS_ADDR A:0x1e04a98
y.create.l HWIO_APPS_SMMU_SSD_REG_679_APPS_ADDR A:0x1e04a9c
y.create.l HWIO_APPS_SMMU_SSD_REG_680_APPS_ADDR A:0x1e04aa0
y.create.l HWIO_APPS_SMMU_SSD_REG_681_APPS_ADDR A:0x1e04aa4
y.create.l HWIO_APPS_SMMU_SSD_REG_682_APPS_ADDR A:0x1e04aa8
y.create.l HWIO_APPS_SMMU_SSD_REG_683_APPS_ADDR A:0x1e04aac
y.create.l HWIO_APPS_SMMU_SSD_REG_684_APPS_ADDR A:0x1e04ab0
y.create.l HWIO_APPS_SMMU_SSD_REG_685_APPS_ADDR A:0x1e04ab4
y.create.l HWIO_APPS_SMMU_SSD_REG_686_APPS_ADDR A:0x1e04ab8
y.create.l HWIO_APPS_SMMU_SSD_REG_687_APPS_ADDR A:0x1e04abc
y.create.l HWIO_APPS_SMMU_SSD_REG_688_APPS_ADDR A:0x1e04ac0
y.create.l HWIO_APPS_SMMU_SSD_REG_689_APPS_ADDR A:0x1e04ac4
y.create.l HWIO_APPS_SMMU_SSD_REG_690_APPS_ADDR A:0x1e04ac8
y.create.l HWIO_APPS_SMMU_SSD_REG_691_APPS_ADDR A:0x1e04acc
y.create.l HWIO_APPS_SMMU_SSD_REG_692_APPS_ADDR A:0x1e04ad0
y.create.l HWIO_APPS_SMMU_SSD_REG_693_APPS_ADDR A:0x1e04ad4
y.create.l HWIO_APPS_SMMU_SSD_REG_694_APPS_ADDR A:0x1e04ad8
y.create.l HWIO_APPS_SMMU_SSD_REG_695_APPS_ADDR A:0x1e04adc
y.create.l HWIO_APPS_SMMU_SSD_REG_696_APPS_ADDR A:0x1e04ae0
y.create.l HWIO_APPS_SMMU_SSD_REG_697_APPS_ADDR A:0x1e04ae4
y.create.l HWIO_APPS_SMMU_SSD_REG_698_APPS_ADDR A:0x1e04ae8
y.create.l HWIO_APPS_SMMU_SSD_REG_699_APPS_ADDR A:0x1e04aec
y.create.l HWIO_APPS_SMMU_SSD_REG_700_APPS_ADDR A:0x1e04af0
y.create.l HWIO_APPS_SMMU_SSD_REG_701_APPS_ADDR A:0x1e04af4
y.create.l HWIO_APPS_SMMU_SSD_REG_702_APPS_ADDR A:0x1e04af8
y.create.l HWIO_APPS_SMMU_SSD_REG_703_APPS_ADDR A:0x1e04afc
y.create.l HWIO_APPS_SMMU_SSD_REG_704_APPS_ADDR A:0x1e04b00
y.create.l HWIO_APPS_SMMU_SSD_REG_705_APPS_ADDR A:0x1e04b04
y.create.l HWIO_APPS_SMMU_SSD_REG_706_APPS_ADDR A:0x1e04b08
y.create.l HWIO_APPS_SMMU_SSD_REG_707_APPS_ADDR A:0x1e04b0c
y.create.l HWIO_APPS_SMMU_SSD_REG_708_APPS_ADDR A:0x1e04b10
y.create.l HWIO_APPS_SMMU_SSD_REG_709_APPS_ADDR A:0x1e04b14
y.create.l HWIO_APPS_SMMU_SSD_REG_710_APPS_ADDR A:0x1e04b18
y.create.l HWIO_APPS_SMMU_SSD_REG_711_APPS_ADDR A:0x1e04b1c
y.create.l HWIO_APPS_SMMU_SSD_REG_712_APPS_ADDR A:0x1e04b20
y.create.l HWIO_APPS_SMMU_SSD_REG_713_APPS_ADDR A:0x1e04b24
y.create.l HWIO_APPS_SMMU_SSD_REG_714_APPS_ADDR A:0x1e04b28
y.create.l HWIO_APPS_SMMU_SSD_REG_715_APPS_ADDR A:0x1e04b2c
y.create.l HWIO_APPS_SMMU_SSD_REG_716_APPS_ADDR A:0x1e04b30
y.create.l HWIO_APPS_SMMU_SSD_REG_717_APPS_ADDR A:0x1e04b34
y.create.l HWIO_APPS_SMMU_SSD_REG_718_APPS_ADDR A:0x1e04b38
y.create.l HWIO_APPS_SMMU_SSD_REG_719_APPS_ADDR A:0x1e04b3c
y.create.l HWIO_APPS_SMMU_SSD_REG_720_APPS_ADDR A:0x1e04b40
y.create.l HWIO_APPS_SMMU_SSD_REG_721_APPS_ADDR A:0x1e04b44
y.create.l HWIO_APPS_SMMU_SSD_REG_722_APPS_ADDR A:0x1e04b48
y.create.l HWIO_APPS_SMMU_SSD_REG_723_APPS_ADDR A:0x1e04b4c
y.create.l HWIO_APPS_SMMU_SSD_REG_724_APPS_ADDR A:0x1e04b50
y.create.l HWIO_APPS_SMMU_SSD_REG_725_APPS_ADDR A:0x1e04b54
y.create.l HWIO_APPS_SMMU_SSD_REG_726_APPS_ADDR A:0x1e04b58
y.create.l HWIO_APPS_SMMU_SSD_REG_727_APPS_ADDR A:0x1e04b5c
y.create.l HWIO_APPS_SMMU_SSD_REG_728_APPS_ADDR A:0x1e04b60
y.create.l HWIO_APPS_SMMU_SSD_REG_729_APPS_ADDR A:0x1e04b64
y.create.l HWIO_APPS_SMMU_SSD_REG_730_APPS_ADDR A:0x1e04b68
y.create.l HWIO_APPS_SMMU_SSD_REG_731_APPS_ADDR A:0x1e04b6c
y.create.l HWIO_APPS_SMMU_SSD_REG_732_APPS_ADDR A:0x1e04b70
y.create.l HWIO_APPS_SMMU_SSD_REG_733_APPS_ADDR A:0x1e04b74
y.create.l HWIO_APPS_SMMU_SSD_REG_734_APPS_ADDR A:0x1e04b78
y.create.l HWIO_APPS_SMMU_SSD_REG_735_APPS_ADDR A:0x1e04b7c
y.create.l HWIO_APPS_SMMU_SSD_REG_736_APPS_ADDR A:0x1e04b80
y.create.l HWIO_APPS_SMMU_SSD_REG_737_APPS_ADDR A:0x1e04b84
y.create.l HWIO_APPS_SMMU_SSD_REG_738_APPS_ADDR A:0x1e04b88
y.create.l HWIO_APPS_SMMU_SSD_REG_739_APPS_ADDR A:0x1e04b8c
y.create.l HWIO_APPS_SMMU_SSD_REG_740_APPS_ADDR A:0x1e04b90
y.create.l HWIO_APPS_SMMU_SSD_REG_741_APPS_ADDR A:0x1e04b94
y.create.l HWIO_APPS_SMMU_SSD_REG_742_APPS_ADDR A:0x1e04b98
y.create.l HWIO_APPS_SMMU_SSD_REG_743_APPS_ADDR A:0x1e04b9c
y.create.l HWIO_APPS_SMMU_SSD_REG_744_APPS_ADDR A:0x1e04ba0
y.create.l HWIO_APPS_SMMU_SSD_REG_745_APPS_ADDR A:0x1e04ba4
y.create.l HWIO_APPS_SMMU_SSD_REG_746_APPS_ADDR A:0x1e04ba8
y.create.l HWIO_APPS_SMMU_SSD_REG_747_APPS_ADDR A:0x1e04bac
y.create.l HWIO_APPS_SMMU_SSD_REG_748_APPS_ADDR A:0x1e04bb0
y.create.l HWIO_APPS_SMMU_SSD_REG_749_APPS_ADDR A:0x1e04bb4
y.create.l HWIO_APPS_SMMU_SSD_REG_750_APPS_ADDR A:0x1e04bb8
y.create.l HWIO_APPS_SMMU_SSD_REG_751_APPS_ADDR A:0x1e04bbc
y.create.l HWIO_APPS_SMMU_SSD_REG_752_APPS_ADDR A:0x1e04bc0
y.create.l HWIO_APPS_SMMU_SSD_REG_753_APPS_ADDR A:0x1e04bc4
y.create.l HWIO_APPS_SMMU_SSD_REG_754_APPS_ADDR A:0x1e04bc8
y.create.l HWIO_APPS_SMMU_SSD_REG_755_APPS_ADDR A:0x1e04bcc
y.create.l HWIO_APPS_SMMU_SSD_REG_756_APPS_ADDR A:0x1e04bd0
y.create.l HWIO_APPS_SMMU_SSD_REG_757_APPS_ADDR A:0x1e04bd4
y.create.l HWIO_APPS_SMMU_SSD_REG_758_APPS_ADDR A:0x1e04bd8
y.create.l HWIO_APPS_SMMU_SSD_REG_759_APPS_ADDR A:0x1e04bdc
y.create.l HWIO_APPS_SMMU_SSD_REG_760_APPS_ADDR A:0x1e04be0
y.create.l HWIO_APPS_SMMU_SSD_REG_761_APPS_ADDR A:0x1e04be4
y.create.l HWIO_APPS_SMMU_SSD_REG_762_APPS_ADDR A:0x1e04be8
y.create.l HWIO_APPS_SMMU_SSD_REG_763_APPS_ADDR A:0x1e04bec
y.create.l HWIO_APPS_SMMU_SSD_REG_764_APPS_ADDR A:0x1e04bf0
y.create.l HWIO_APPS_SMMU_SSD_REG_765_APPS_ADDR A:0x1e04bf4
y.create.l HWIO_APPS_SMMU_SSD_REG_766_APPS_ADDR A:0x1e04bf8
y.create.l HWIO_APPS_SMMU_SSD_REG_767_APPS_ADDR A:0x1e04bfc
y.create.l HWIO_APPS_SMMU_SSD_REG_768_APPS_ADDR A:0x1e04c00
y.create.l HWIO_APPS_SMMU_SSD_REG_769_APPS_ADDR A:0x1e04c04
y.create.l HWIO_APPS_SMMU_SSD_REG_770_APPS_ADDR A:0x1e04c08
y.create.l HWIO_APPS_SMMU_SSD_REG_771_APPS_ADDR A:0x1e04c0c
y.create.l HWIO_APPS_SMMU_SSD_REG_772_APPS_ADDR A:0x1e04c10
y.create.l HWIO_APPS_SMMU_SSD_REG_773_APPS_ADDR A:0x1e04c14
y.create.l HWIO_APPS_SMMU_SSD_REG_774_APPS_ADDR A:0x1e04c18
y.create.l HWIO_APPS_SMMU_SSD_REG_775_APPS_ADDR A:0x1e04c1c
y.create.l HWIO_APPS_SMMU_SSD_REG_776_APPS_ADDR A:0x1e04c20
y.create.l HWIO_APPS_SMMU_SSD_REG_777_APPS_ADDR A:0x1e04c24
y.create.l HWIO_APPS_SMMU_SSD_REG_778_APPS_ADDR A:0x1e04c28
y.create.l HWIO_APPS_SMMU_SSD_REG_779_APPS_ADDR A:0x1e04c2c
y.create.l HWIO_APPS_SMMU_SSD_REG_780_APPS_ADDR A:0x1e04c30
y.create.l HWIO_APPS_SMMU_SSD_REG_781_APPS_ADDR A:0x1e04c34
y.create.l HWIO_APPS_SMMU_SSD_REG_782_APPS_ADDR A:0x1e04c38
y.create.l HWIO_APPS_SMMU_SSD_REG_783_APPS_ADDR A:0x1e04c3c
y.create.l HWIO_APPS_SMMU_SSD_REG_784_APPS_ADDR A:0x1e04c40
y.create.l HWIO_APPS_SMMU_SSD_REG_785_APPS_ADDR A:0x1e04c44
y.create.l HWIO_APPS_SMMU_SSD_REG_786_APPS_ADDR A:0x1e04c48
y.create.l HWIO_APPS_SMMU_SSD_REG_787_APPS_ADDR A:0x1e04c4c
y.create.l HWIO_APPS_SMMU_SSD_REG_788_APPS_ADDR A:0x1e04c50
y.create.l HWIO_APPS_SMMU_SSD_REG_789_APPS_ADDR A:0x1e04c54
y.create.l HWIO_APPS_SMMU_SSD_REG_790_APPS_ADDR A:0x1e04c58
y.create.l HWIO_APPS_SMMU_SSD_REG_791_APPS_ADDR A:0x1e04c5c
y.create.l HWIO_APPS_SMMU_SSD_REG_792_APPS_ADDR A:0x1e04c60
y.create.l HWIO_APPS_SMMU_SSD_REG_793_APPS_ADDR A:0x1e04c64
y.create.l HWIO_APPS_SMMU_SSD_REG_794_APPS_ADDR A:0x1e04c68
y.create.l HWIO_APPS_SMMU_SSD_REG_795_APPS_ADDR A:0x1e04c6c
y.create.l HWIO_APPS_SMMU_SSD_REG_796_APPS_ADDR A:0x1e04c70
y.create.l HWIO_APPS_SMMU_SSD_REG_797_APPS_ADDR A:0x1e04c74
y.create.l HWIO_APPS_SMMU_SSD_REG_798_APPS_ADDR A:0x1e04c78
y.create.l HWIO_APPS_SMMU_SSD_REG_799_APPS_ADDR A:0x1e04c7c
y.create.l HWIO_APPS_SMMU_SSD_REG_800_APPS_ADDR A:0x1e04c80
y.create.l HWIO_APPS_SMMU_SSD_REG_801_APPS_ADDR A:0x1e04c84
y.create.l HWIO_APPS_SMMU_SSD_REG_802_APPS_ADDR A:0x1e04c88
y.create.l HWIO_APPS_SMMU_SSD_REG_803_APPS_ADDR A:0x1e04c8c
y.create.l HWIO_APPS_SMMU_SSD_REG_804_APPS_ADDR A:0x1e04c90
y.create.l HWIO_APPS_SMMU_SSD_REG_805_APPS_ADDR A:0x1e04c94
y.create.l HWIO_APPS_SMMU_SSD_REG_806_APPS_ADDR A:0x1e04c98
y.create.l HWIO_APPS_SMMU_SSD_REG_807_APPS_ADDR A:0x1e04c9c
y.create.l HWIO_APPS_SMMU_SSD_REG_808_APPS_ADDR A:0x1e04ca0
y.create.l HWIO_APPS_SMMU_SSD_REG_809_APPS_ADDR A:0x1e04ca4
y.create.l HWIO_APPS_SMMU_SSD_REG_810_APPS_ADDR A:0x1e04ca8
y.create.l HWIO_APPS_SMMU_SSD_REG_811_APPS_ADDR A:0x1e04cac
y.create.l HWIO_APPS_SMMU_SSD_REG_812_APPS_ADDR A:0x1e04cb0
y.create.l HWIO_APPS_SMMU_SSD_REG_813_APPS_ADDR A:0x1e04cb4
y.create.l HWIO_APPS_SMMU_SSD_REG_814_APPS_ADDR A:0x1e04cb8
y.create.l HWIO_APPS_SMMU_SSD_REG_815_APPS_ADDR A:0x1e04cbc
y.create.l HWIO_APPS_SMMU_SSD_REG_816_APPS_ADDR A:0x1e04cc0
y.create.l HWIO_APPS_SMMU_SSD_REG_817_APPS_ADDR A:0x1e04cc4
y.create.l HWIO_APPS_SMMU_SSD_REG_818_APPS_ADDR A:0x1e04cc8
y.create.l HWIO_APPS_SMMU_SSD_REG_819_APPS_ADDR A:0x1e04ccc
y.create.l HWIO_APPS_SMMU_SSD_REG_820_APPS_ADDR A:0x1e04cd0
y.create.l HWIO_APPS_SMMU_SSD_REG_821_APPS_ADDR A:0x1e04cd4
y.create.l HWIO_APPS_SMMU_SSD_REG_822_APPS_ADDR A:0x1e04cd8
y.create.l HWIO_APPS_SMMU_SSD_REG_823_APPS_ADDR A:0x1e04cdc
y.create.l HWIO_APPS_SMMU_SSD_REG_824_APPS_ADDR A:0x1e04ce0
y.create.l HWIO_APPS_SMMU_SSD_REG_825_APPS_ADDR A:0x1e04ce4
y.create.l HWIO_APPS_SMMU_SSD_REG_826_APPS_ADDR A:0x1e04ce8
y.create.l HWIO_APPS_SMMU_SSD_REG_827_APPS_ADDR A:0x1e04cec
y.create.l HWIO_APPS_SMMU_SSD_REG_828_APPS_ADDR A:0x1e04cf0
y.create.l HWIO_APPS_SMMU_SSD_REG_829_APPS_ADDR A:0x1e04cf4
y.create.l HWIO_APPS_SMMU_SSD_REG_830_APPS_ADDR A:0x1e04cf8
y.create.l HWIO_APPS_SMMU_SSD_REG_831_APPS_ADDR A:0x1e04cfc
y.create.l HWIO_APPS_SMMU_SSD_REG_832_APPS_ADDR A:0x1e04d00
y.create.l HWIO_APPS_SMMU_SSD_REG_833_APPS_ADDR A:0x1e04d04
y.create.l HWIO_APPS_SMMU_SSD_REG_834_APPS_ADDR A:0x1e04d08
y.create.l HWIO_APPS_SMMU_SSD_REG_835_APPS_ADDR A:0x1e04d0c
y.create.l HWIO_APPS_SMMU_SSD_REG_836_APPS_ADDR A:0x1e04d10
y.create.l HWIO_APPS_SMMU_SSD_REG_837_APPS_ADDR A:0x1e04d14
y.create.l HWIO_APPS_SMMU_SSD_REG_838_APPS_ADDR A:0x1e04d18
y.create.l HWIO_APPS_SMMU_SSD_REG_839_APPS_ADDR A:0x1e04d1c
y.create.l HWIO_APPS_SMMU_SSD_REG_840_APPS_ADDR A:0x1e04d20
y.create.l HWIO_APPS_SMMU_SSD_REG_841_APPS_ADDR A:0x1e04d24
y.create.l HWIO_APPS_SMMU_SSD_REG_842_APPS_ADDR A:0x1e04d28
y.create.l HWIO_APPS_SMMU_SSD_REG_843_APPS_ADDR A:0x1e04d2c
y.create.l HWIO_APPS_SMMU_SSD_REG_844_APPS_ADDR A:0x1e04d30
y.create.l HWIO_APPS_SMMU_SSD_REG_845_APPS_ADDR A:0x1e04d34
y.create.l HWIO_APPS_SMMU_SSD_REG_846_APPS_ADDR A:0x1e04d38
y.create.l HWIO_APPS_SMMU_SSD_REG_847_APPS_ADDR A:0x1e04d3c
y.create.l HWIO_APPS_SMMU_SSD_REG_848_APPS_ADDR A:0x1e04d40
y.create.l HWIO_APPS_SMMU_SSD_REG_849_APPS_ADDR A:0x1e04d44
y.create.l HWIO_APPS_SMMU_SSD_REG_850_APPS_ADDR A:0x1e04d48
y.create.l HWIO_APPS_SMMU_SSD_REG_851_APPS_ADDR A:0x1e04d4c
y.create.l HWIO_APPS_SMMU_SSD_REG_852_APPS_ADDR A:0x1e04d50
y.create.l HWIO_APPS_SMMU_SSD_REG_853_APPS_ADDR A:0x1e04d54
y.create.l HWIO_APPS_SMMU_SSD_REG_854_APPS_ADDR A:0x1e04d58
y.create.l HWIO_APPS_SMMU_SSD_REG_855_APPS_ADDR A:0x1e04d5c
y.create.l HWIO_APPS_SMMU_SSD_REG_856_APPS_ADDR A:0x1e04d60
y.create.l HWIO_APPS_SMMU_SSD_REG_857_APPS_ADDR A:0x1e04d64
y.create.l HWIO_APPS_SMMU_SSD_REG_858_APPS_ADDR A:0x1e04d68
y.create.l HWIO_APPS_SMMU_SSD_REG_859_APPS_ADDR A:0x1e04d6c
y.create.l HWIO_APPS_SMMU_SSD_REG_860_APPS_ADDR A:0x1e04d70
y.create.l HWIO_APPS_SMMU_SSD_REG_861_APPS_ADDR A:0x1e04d74
y.create.l HWIO_APPS_SMMU_SSD_REG_862_APPS_ADDR A:0x1e04d78
y.create.l HWIO_APPS_SMMU_SSD_REG_863_APPS_ADDR A:0x1e04d7c
y.create.l HWIO_APPS_SMMU_SSD_REG_864_APPS_ADDR A:0x1e04d80
y.create.l HWIO_APPS_SMMU_SSD_REG_865_APPS_ADDR A:0x1e04d84
y.create.l HWIO_APPS_SMMU_SSD_REG_866_APPS_ADDR A:0x1e04d88
y.create.l HWIO_APPS_SMMU_SSD_REG_867_APPS_ADDR A:0x1e04d8c
y.create.l HWIO_APPS_SMMU_SSD_REG_868_APPS_ADDR A:0x1e04d90
y.create.l HWIO_APPS_SMMU_SSD_REG_869_APPS_ADDR A:0x1e04d94
y.create.l HWIO_APPS_SMMU_SSD_REG_870_APPS_ADDR A:0x1e04d98
y.create.l HWIO_APPS_SMMU_SSD_REG_871_APPS_ADDR A:0x1e04d9c
y.create.l HWIO_APPS_SMMU_SSD_REG_872_APPS_ADDR A:0x1e04da0
y.create.l HWIO_APPS_SMMU_SSD_REG_873_APPS_ADDR A:0x1e04da4
y.create.l HWIO_APPS_SMMU_SSD_REG_874_APPS_ADDR A:0x1e04da8
y.create.l HWIO_APPS_SMMU_SSD_REG_875_APPS_ADDR A:0x1e04dac
y.create.l HWIO_APPS_SMMU_SSD_REG_876_APPS_ADDR A:0x1e04db0
y.create.l HWIO_APPS_SMMU_SSD_REG_877_APPS_ADDR A:0x1e04db4
y.create.l HWIO_APPS_SMMU_SSD_REG_878_APPS_ADDR A:0x1e04db8
y.create.l HWIO_APPS_SMMU_SSD_REG_879_APPS_ADDR A:0x1e04dbc
y.create.l HWIO_APPS_SMMU_SSD_REG_880_APPS_ADDR A:0x1e04dc0
y.create.l HWIO_APPS_SMMU_SSD_REG_881_APPS_ADDR A:0x1e04dc4
y.create.l HWIO_APPS_SMMU_SSD_REG_882_APPS_ADDR A:0x1e04dc8
y.create.l HWIO_APPS_SMMU_SSD_REG_883_APPS_ADDR A:0x1e04dcc
y.create.l HWIO_APPS_SMMU_SSD_REG_884_APPS_ADDR A:0x1e04dd0
y.create.l HWIO_APPS_SMMU_SSD_REG_885_APPS_ADDR A:0x1e04dd4
y.create.l HWIO_APPS_SMMU_SSD_REG_886_APPS_ADDR A:0x1e04dd8
y.create.l HWIO_APPS_SMMU_SSD_REG_887_APPS_ADDR A:0x1e04ddc
y.create.l HWIO_APPS_SMMU_SSD_REG_888_APPS_ADDR A:0x1e04de0
y.create.l HWIO_APPS_SMMU_SSD_REG_889_APPS_ADDR A:0x1e04de4
y.create.l HWIO_APPS_SMMU_SSD_REG_890_APPS_ADDR A:0x1e04de8
y.create.l HWIO_APPS_SMMU_SSD_REG_891_APPS_ADDR A:0x1e04dec
y.create.l HWIO_APPS_SMMU_SSD_REG_892_APPS_ADDR A:0x1e04df0
y.create.l HWIO_APPS_SMMU_SSD_REG_893_APPS_ADDR A:0x1e04df4
y.create.l HWIO_APPS_SMMU_SSD_REG_894_APPS_ADDR A:0x1e04df8
y.create.l HWIO_APPS_SMMU_SSD_REG_895_APPS_ADDR A:0x1e04dfc
y.create.l HWIO_APPS_SMMU_SSD_REG_896_APPS_ADDR A:0x1e04e00
y.create.l HWIO_APPS_SMMU_SSD_REG_897_APPS_ADDR A:0x1e04e04
y.create.l HWIO_APPS_SMMU_SSD_REG_898_APPS_ADDR A:0x1e04e08
y.create.l HWIO_APPS_SMMU_SSD_REG_899_APPS_ADDR A:0x1e04e0c
y.create.l HWIO_APPS_SMMU_SSD_REG_900_APPS_ADDR A:0x1e04e10
y.create.l HWIO_APPS_SMMU_SSD_REG_901_APPS_ADDR A:0x1e04e14
y.create.l HWIO_APPS_SMMU_SSD_REG_902_APPS_ADDR A:0x1e04e18
y.create.l HWIO_APPS_SMMU_SSD_REG_903_APPS_ADDR A:0x1e04e1c
y.create.l HWIO_APPS_SMMU_SSD_REG_904_APPS_ADDR A:0x1e04e20
y.create.l HWIO_APPS_SMMU_SSD_REG_905_APPS_ADDR A:0x1e04e24
y.create.l HWIO_APPS_SMMU_SSD_REG_906_APPS_ADDR A:0x1e04e28
y.create.l HWIO_APPS_SMMU_SSD_REG_907_APPS_ADDR A:0x1e04e2c
y.create.l HWIO_APPS_SMMU_SSD_REG_908_APPS_ADDR A:0x1e04e30
y.create.l HWIO_APPS_SMMU_SSD_REG_909_APPS_ADDR A:0x1e04e34
y.create.l HWIO_APPS_SMMU_SSD_REG_910_APPS_ADDR A:0x1e04e38
y.create.l HWIO_APPS_SMMU_SSD_REG_911_APPS_ADDR A:0x1e04e3c
y.create.l HWIO_APPS_SMMU_SSD_REG_912_APPS_ADDR A:0x1e04e40
y.create.l HWIO_APPS_SMMU_SSD_REG_913_APPS_ADDR A:0x1e04e44
y.create.l HWIO_APPS_SMMU_SSD_REG_914_APPS_ADDR A:0x1e04e48
y.create.l HWIO_APPS_SMMU_SSD_REG_915_APPS_ADDR A:0x1e04e4c
y.create.l HWIO_APPS_SMMU_SSD_REG_916_APPS_ADDR A:0x1e04e50
y.create.l HWIO_APPS_SMMU_SSD_REG_917_APPS_ADDR A:0x1e04e54
y.create.l HWIO_APPS_SMMU_SSD_REG_918_APPS_ADDR A:0x1e04e58
y.create.l HWIO_APPS_SMMU_SSD_REG_919_APPS_ADDR A:0x1e04e5c
y.create.l HWIO_APPS_SMMU_SSD_REG_920_APPS_ADDR A:0x1e04e60
y.create.l HWIO_APPS_SMMU_SSD_REG_921_APPS_ADDR A:0x1e04e64
y.create.l HWIO_APPS_SMMU_SSD_REG_922_APPS_ADDR A:0x1e04e68
y.create.l HWIO_APPS_SMMU_SSD_REG_923_APPS_ADDR A:0x1e04e6c
y.create.l HWIO_APPS_SMMU_SSD_REG_924_APPS_ADDR A:0x1e04e70
y.create.l HWIO_APPS_SMMU_SSD_REG_925_APPS_ADDR A:0x1e04e74
y.create.l HWIO_APPS_SMMU_SSD_REG_926_APPS_ADDR A:0x1e04e78
y.create.l HWIO_APPS_SMMU_SSD_REG_927_APPS_ADDR A:0x1e04e7c
y.create.l HWIO_APPS_SMMU_SSD_REG_928_APPS_ADDR A:0x1e04e80
y.create.l HWIO_APPS_SMMU_SSD_REG_929_APPS_ADDR A:0x1e04e84
y.create.l HWIO_APPS_SMMU_SSD_REG_930_APPS_ADDR A:0x1e04e88
y.create.l HWIO_APPS_SMMU_SSD_REG_931_APPS_ADDR A:0x1e04e8c
y.create.l HWIO_APPS_SMMU_SSD_REG_932_APPS_ADDR A:0x1e04e90
y.create.l HWIO_APPS_SMMU_SSD_REG_933_APPS_ADDR A:0x1e04e94
y.create.l HWIO_APPS_SMMU_SSD_REG_934_APPS_ADDR A:0x1e04e98
y.create.l HWIO_APPS_SMMU_SSD_REG_935_APPS_ADDR A:0x1e04e9c
y.create.l HWIO_APPS_SMMU_SSD_REG_936_APPS_ADDR A:0x1e04ea0
y.create.l HWIO_APPS_SMMU_SSD_REG_937_APPS_ADDR A:0x1e04ea4
y.create.l HWIO_APPS_SMMU_SSD_REG_938_APPS_ADDR A:0x1e04ea8
y.create.l HWIO_APPS_SMMU_SSD_REG_939_APPS_ADDR A:0x1e04eac
y.create.l HWIO_APPS_SMMU_SSD_REG_940_APPS_ADDR A:0x1e04eb0
y.create.l HWIO_APPS_SMMU_SSD_REG_941_APPS_ADDR A:0x1e04eb4
y.create.l HWIO_APPS_SMMU_SSD_REG_942_APPS_ADDR A:0x1e04eb8
y.create.l HWIO_APPS_SMMU_SSD_REG_943_APPS_ADDR A:0x1e04ebc
y.create.l HWIO_APPS_SMMU_SSD_REG_944_APPS_ADDR A:0x1e04ec0
y.create.l HWIO_APPS_SMMU_SSD_REG_945_APPS_ADDR A:0x1e04ec4
y.create.l HWIO_APPS_SMMU_SSD_REG_946_APPS_ADDR A:0x1e04ec8
y.create.l HWIO_APPS_SMMU_SSD_REG_947_APPS_ADDR A:0x1e04ecc
y.create.l HWIO_APPS_SMMU_SSD_REG_948_APPS_ADDR A:0x1e04ed0
y.create.l HWIO_APPS_SMMU_SSD_REG_949_APPS_ADDR A:0x1e04ed4
y.create.l HWIO_APPS_SMMU_SSD_REG_950_APPS_ADDR A:0x1e04ed8
y.create.l HWIO_APPS_SMMU_SSD_REG_951_APPS_ADDR A:0x1e04edc
y.create.l HWIO_APPS_SMMU_SSD_REG_952_APPS_ADDR A:0x1e04ee0
y.create.l HWIO_APPS_SMMU_SSD_REG_953_APPS_ADDR A:0x1e04ee4
y.create.l HWIO_APPS_SMMU_SSD_REG_954_APPS_ADDR A:0x1e04ee8
y.create.l HWIO_APPS_SMMU_SSD_REG_955_APPS_ADDR A:0x1e04eec
y.create.l HWIO_APPS_SMMU_SSD_REG_956_APPS_ADDR A:0x1e04ef0
y.create.l HWIO_APPS_SMMU_SSD_REG_957_APPS_ADDR A:0x1e04ef4
y.create.l HWIO_APPS_SMMU_SSD_REG_958_APPS_ADDR A:0x1e04ef8
y.create.l HWIO_APPS_SMMU_SSD_REG_959_APPS_ADDR A:0x1e04efc
y.create.l HWIO_APPS_SMMU_SSD_REG_960_APPS_ADDR A:0x1e04f00
y.create.l HWIO_APPS_SMMU_SSD_REG_961_APPS_ADDR A:0x1e04f04
y.create.l HWIO_APPS_SMMU_SSD_REG_962_APPS_ADDR A:0x1e04f08
y.create.l HWIO_APPS_SMMU_SSD_REG_963_APPS_ADDR A:0x1e04f0c
y.create.l HWIO_APPS_SMMU_SSD_REG_964_APPS_ADDR A:0x1e04f10
y.create.l HWIO_APPS_SMMU_SSD_REG_965_APPS_ADDR A:0x1e04f14
y.create.l HWIO_APPS_SMMU_SSD_REG_966_APPS_ADDR A:0x1e04f18
y.create.l HWIO_APPS_SMMU_SSD_REG_967_APPS_ADDR A:0x1e04f1c
y.create.l HWIO_APPS_SMMU_SSD_REG_968_APPS_ADDR A:0x1e04f20
y.create.l HWIO_APPS_SMMU_SSD_REG_969_APPS_ADDR A:0x1e04f24
y.create.l HWIO_APPS_SMMU_SSD_REG_970_APPS_ADDR A:0x1e04f28
y.create.l HWIO_APPS_SMMU_SSD_REG_971_APPS_ADDR A:0x1e04f2c
y.create.l HWIO_APPS_SMMU_SSD_REG_972_APPS_ADDR A:0x1e04f30
y.create.l HWIO_APPS_SMMU_SSD_REG_973_APPS_ADDR A:0x1e04f34
y.create.l HWIO_APPS_SMMU_SSD_REG_974_APPS_ADDR A:0x1e04f38
y.create.l HWIO_APPS_SMMU_SSD_REG_975_APPS_ADDR A:0x1e04f3c
y.create.l HWIO_APPS_SMMU_SSD_REG_976_APPS_ADDR A:0x1e04f40
y.create.l HWIO_APPS_SMMU_SSD_REG_977_APPS_ADDR A:0x1e04f44
y.create.l HWIO_APPS_SMMU_SSD_REG_978_APPS_ADDR A:0x1e04f48
y.create.l HWIO_APPS_SMMU_SSD_REG_979_APPS_ADDR A:0x1e04f4c
y.create.l HWIO_APPS_SMMU_SSD_REG_980_APPS_ADDR A:0x1e04f50
y.create.l HWIO_APPS_SMMU_SSD_REG_981_APPS_ADDR A:0x1e04f54
y.create.l HWIO_APPS_SMMU_SSD_REG_982_APPS_ADDR A:0x1e04f58
y.create.l HWIO_APPS_SMMU_SSD_REG_983_APPS_ADDR A:0x1e04f5c
y.create.l HWIO_APPS_SMMU_SSD_REG_984_APPS_ADDR A:0x1e04f60
y.create.l HWIO_APPS_SMMU_SSD_REG_985_APPS_ADDR A:0x1e04f64
y.create.l HWIO_APPS_SMMU_SSD_REG_986_APPS_ADDR A:0x1e04f68
y.create.l HWIO_APPS_SMMU_SSD_REG_987_APPS_ADDR A:0x1e04f6c
y.create.l HWIO_APPS_SMMU_SSD_REG_988_APPS_ADDR A:0x1e04f70
y.create.l HWIO_APPS_SMMU_SSD_REG_989_APPS_ADDR A:0x1e04f74
y.create.l HWIO_APPS_SMMU_SSD_REG_990_APPS_ADDR A:0x1e04f78
y.create.l HWIO_APPS_SMMU_SSD_REG_991_APPS_ADDR A:0x1e04f7c
y.create.l HWIO_APPS_SMMU_SSD_REG_992_APPS_ADDR A:0x1e04f80
y.create.l HWIO_APPS_SMMU_SSD_REG_993_APPS_ADDR A:0x1e04f84
y.create.l HWIO_APPS_SMMU_SSD_REG_994_APPS_ADDR A:0x1e04f88
y.create.l HWIO_APPS_SMMU_SSD_REG_995_APPS_ADDR A:0x1e04f8c
y.create.l HWIO_APPS_SMMU_SSD_REG_996_APPS_ADDR A:0x1e04f90
y.create.l HWIO_APPS_SMMU_SSD_REG_997_APPS_ADDR A:0x1e04f94
y.create.l HWIO_APPS_SMMU_SSD_REG_998_APPS_ADDR A:0x1e04f98
y.create.l HWIO_APPS_SMMU_SSD_REG_999_APPS_ADDR A:0x1e04f9c
y.create.l HWIO_APPS_SMMU_SSD_REG_1000_APPS_ADDR A:0x1e04fa0
y.create.l HWIO_APPS_SMMU_SSD_REG_1001_APPS_ADDR A:0x1e04fa4
y.create.l HWIO_APPS_SMMU_SSD_REG_1002_APPS_ADDR A:0x1e04fa8
y.create.l HWIO_APPS_SMMU_SSD_REG_1003_APPS_ADDR A:0x1e04fac
y.create.l HWIO_APPS_SMMU_SSD_REG_1004_APPS_ADDR A:0x1e04fb0
y.create.l HWIO_APPS_SMMU_SSD_REG_1005_APPS_ADDR A:0x1e04fb4
y.create.l HWIO_APPS_SMMU_SSD_REG_1006_APPS_ADDR A:0x1e04fb8
y.create.l HWIO_APPS_SMMU_SSD_REG_1007_APPS_ADDR A:0x1e04fbc
y.create.l HWIO_APPS_SMMU_SSD_REG_1008_APPS_ADDR A:0x1e04fc0
y.create.l HWIO_APPS_SMMU_SSD_REG_1009_APPS_ADDR A:0x1e04fc4
y.create.l HWIO_APPS_SMMU_SSD_REG_1010_APPS_ADDR A:0x1e04fc8
y.create.l HWIO_APPS_SMMU_SSD_REG_1011_APPS_ADDR A:0x1e04fcc
y.create.l HWIO_APPS_SMMU_SSD_REG_1012_APPS_ADDR A:0x1e04fd0
y.create.l HWIO_APPS_SMMU_SSD_REG_1013_APPS_ADDR A:0x1e04fd4
y.create.l HWIO_APPS_SMMU_SSD_REG_1014_APPS_ADDR A:0x1e04fd8
y.create.l HWIO_APPS_SMMU_SSD_REG_1015_APPS_ADDR A:0x1e04fdc
y.create.l HWIO_APPS_SMMU_SSD_REG_1016_APPS_ADDR A:0x1e04fe0
y.create.l HWIO_APPS_SMMU_SSD_REG_1017_APPS_ADDR A:0x1e04fe4
y.create.l HWIO_APPS_SMMU_SSD_REG_1018_APPS_ADDR A:0x1e04fe8
y.create.l HWIO_APPS_SMMU_SSD_REG_1019_APPS_ADDR A:0x1e04fec
y.create.l HWIO_APPS_SMMU_SSD_REG_1020_APPS_ADDR A:0x1e04ff0
y.create.l HWIO_APPS_SMMU_SSD_REG_1021_APPS_ADDR A:0x1e04ff4
y.create.l HWIO_APPS_SMMU_SSD_REG_1022_APPS_ADDR A:0x1e04ff8
y.create.l HWIO_APPS_SMMU_SSD_REG_1023_APPS_ADDR A:0x1e04ffc
y.create.l HWIO_APPS_SMMU_CB0_SCTLR_APPS_ADDR A:0x1e10000
y.create.l HWIO_APPS_SMMU_CB1_SCTLR_APPS_ADDR A:0x1e11000
y.create.l HWIO_APPS_SMMU_CB2_SCTLR_APPS_ADDR A:0x1e12000
y.create.l HWIO_APPS_SMMU_CB3_SCTLR_APPS_ADDR A:0x1e13000
y.create.l HWIO_APPS_SMMU_CB4_SCTLR_APPS_ADDR A:0x1e14000
y.create.l HWIO_APPS_SMMU_CB5_SCTLR_APPS_ADDR A:0x1e15000
y.create.l HWIO_APPS_SMMU_CB6_SCTLR_APPS_ADDR A:0x1e16000
y.create.l HWIO_APPS_SMMU_CB7_SCTLR_APPS_ADDR A:0x1e17000
y.create.l HWIO_APPS_SMMU_CB8_SCTLR_APPS_ADDR A:0x1e18000
y.create.l HWIO_APPS_SMMU_CB9_SCTLR_APPS_ADDR A:0x1e19000
y.create.l HWIO_APPS_SMMU_CB10_SCTLR_APPS_ADDR A:0x1e1a000
y.create.l HWIO_APPS_SMMU_CB11_SCTLR_APPS_ADDR A:0x1e1b000
y.create.l HWIO_APPS_SMMU_CB12_SCTLR_APPS_ADDR A:0x1e1c000
y.create.l HWIO_APPS_SMMU_CB13_SCTLR_APPS_ADDR A:0x1e1d000
y.create.l HWIO_APPS_SMMU_CB14_SCTLR_APPS_ADDR A:0x1e1e000
y.create.l HWIO_APPS_SMMU_CB15_SCTLR_APPS_ADDR A:0x1e1f000
y.create.l HWIO_APPS_SMMU_CB0_ACTLR_APPS_ADDR A:0x1e10004
y.create.l HWIO_APPS_SMMU_CB1_ACTLR_APPS_ADDR A:0x1e11004
y.create.l HWIO_APPS_SMMU_CB2_ACTLR_APPS_ADDR A:0x1e12004
y.create.l HWIO_APPS_SMMU_CB3_ACTLR_APPS_ADDR A:0x1e13004
y.create.l HWIO_APPS_SMMU_CB4_ACTLR_APPS_ADDR A:0x1e14004
y.create.l HWIO_APPS_SMMU_CB5_ACTLR_APPS_ADDR A:0x1e15004
y.create.l HWIO_APPS_SMMU_CB6_ACTLR_APPS_ADDR A:0x1e16004
y.create.l HWIO_APPS_SMMU_CB7_ACTLR_APPS_ADDR A:0x1e17004
y.create.l HWIO_APPS_SMMU_CB8_ACTLR_APPS_ADDR A:0x1e18004
y.create.l HWIO_APPS_SMMU_CB9_ACTLR_APPS_ADDR A:0x1e19004
y.create.l HWIO_APPS_SMMU_CB10_ACTLR_APPS_ADDR A:0x1e1a004
y.create.l HWIO_APPS_SMMU_CB11_ACTLR_APPS_ADDR A:0x1e1b004
y.create.l HWIO_APPS_SMMU_CB12_ACTLR_APPS_ADDR A:0x1e1c004
y.create.l HWIO_APPS_SMMU_CB13_ACTLR_APPS_ADDR A:0x1e1d004
y.create.l HWIO_APPS_SMMU_CB14_ACTLR_APPS_ADDR A:0x1e1e004
y.create.l HWIO_APPS_SMMU_CB15_ACTLR_APPS_ADDR A:0x1e1f004
y.create.l HWIO_APPS_SMMU_CB0_RESUME_APPS_ADDR A:0x1e10008
y.create.l HWIO_APPS_SMMU_CB1_RESUME_APPS_ADDR A:0x1e11008
y.create.l HWIO_APPS_SMMU_CB2_RESUME_APPS_ADDR A:0x1e12008
y.create.l HWIO_APPS_SMMU_CB3_RESUME_APPS_ADDR A:0x1e13008
y.create.l HWIO_APPS_SMMU_CB4_RESUME_APPS_ADDR A:0x1e14008
y.create.l HWIO_APPS_SMMU_CB5_RESUME_APPS_ADDR A:0x1e15008
y.create.l HWIO_APPS_SMMU_CB6_RESUME_APPS_ADDR A:0x1e16008
y.create.l HWIO_APPS_SMMU_CB7_RESUME_APPS_ADDR A:0x1e17008
y.create.l HWIO_APPS_SMMU_CB8_RESUME_APPS_ADDR A:0x1e18008
y.create.l HWIO_APPS_SMMU_CB9_RESUME_APPS_ADDR A:0x1e19008
y.create.l HWIO_APPS_SMMU_CB10_RESUME_APPS_ADDR A:0x1e1a008
y.create.l HWIO_APPS_SMMU_CB11_RESUME_APPS_ADDR A:0x1e1b008
y.create.l HWIO_APPS_SMMU_CB12_RESUME_APPS_ADDR A:0x1e1c008
y.create.l HWIO_APPS_SMMU_CB13_RESUME_APPS_ADDR A:0x1e1d008
y.create.l HWIO_APPS_SMMU_CB14_RESUME_APPS_ADDR A:0x1e1e008
y.create.l HWIO_APPS_SMMU_CB15_RESUME_APPS_ADDR A:0x1e1f008
y.create.l HWIO_APPS_SMMU_CB0_TCR2_APPS_ADDR A:0x1e10010
y.create.l HWIO_APPS_SMMU_CB1_TCR2_APPS_ADDR A:0x1e11010
y.create.l HWIO_APPS_SMMU_CB2_TCR2_APPS_ADDR A:0x1e12010
y.create.l HWIO_APPS_SMMU_CB3_TCR2_APPS_ADDR A:0x1e13010
y.create.l HWIO_APPS_SMMU_CB4_TCR2_APPS_ADDR A:0x1e14010
y.create.l HWIO_APPS_SMMU_CB5_TCR2_APPS_ADDR A:0x1e15010
y.create.l HWIO_APPS_SMMU_CB6_TCR2_APPS_ADDR A:0x1e16010
y.create.l HWIO_APPS_SMMU_CB7_TCR2_APPS_ADDR A:0x1e17010
y.create.l HWIO_APPS_SMMU_CB8_TCR2_APPS_ADDR A:0x1e18010
y.create.l HWIO_APPS_SMMU_CB9_TCR2_APPS_ADDR A:0x1e19010
y.create.l HWIO_APPS_SMMU_CB10_TCR2_APPS_ADDR A:0x1e1a010
y.create.l HWIO_APPS_SMMU_CB11_TCR2_APPS_ADDR A:0x1e1b010
y.create.l HWIO_APPS_SMMU_CB12_TCR2_APPS_ADDR A:0x1e1c010
y.create.l HWIO_APPS_SMMU_CB13_TCR2_APPS_ADDR A:0x1e1d010
y.create.l HWIO_APPS_SMMU_CB14_TCR2_APPS_ADDR A:0x1e1e010
y.create.l HWIO_APPS_SMMU_CB15_TCR2_APPS_ADDR A:0x1e1f010
y.create.l HWIO_APPS_SMMU_CB0_TTBR0_LOW_APPS_ADDR A:0x1e10020
y.create.l HWIO_APPS_SMMU_CB1_TTBR0_LOW_APPS_ADDR A:0x1e11020
y.create.l HWIO_APPS_SMMU_CB2_TTBR0_LOW_APPS_ADDR A:0x1e12020
y.create.l HWIO_APPS_SMMU_CB3_TTBR0_LOW_APPS_ADDR A:0x1e13020
y.create.l HWIO_APPS_SMMU_CB4_TTBR0_LOW_APPS_ADDR A:0x1e14020
y.create.l HWIO_APPS_SMMU_CB5_TTBR0_LOW_APPS_ADDR A:0x1e15020
y.create.l HWIO_APPS_SMMU_CB6_TTBR0_LOW_APPS_ADDR A:0x1e16020
y.create.l HWIO_APPS_SMMU_CB7_TTBR0_LOW_APPS_ADDR A:0x1e17020
y.create.l HWIO_APPS_SMMU_CB8_TTBR0_LOW_APPS_ADDR A:0x1e18020
y.create.l HWIO_APPS_SMMU_CB9_TTBR0_LOW_APPS_ADDR A:0x1e19020
y.create.l HWIO_APPS_SMMU_CB10_TTBR0_LOW_APPS_ADDR A:0x1e1a020
y.create.l HWIO_APPS_SMMU_CB11_TTBR0_LOW_APPS_ADDR A:0x1e1b020
y.create.l HWIO_APPS_SMMU_CB12_TTBR0_LOW_APPS_ADDR A:0x1e1c020
y.create.l HWIO_APPS_SMMU_CB13_TTBR0_LOW_APPS_ADDR A:0x1e1d020
y.create.l HWIO_APPS_SMMU_CB14_TTBR0_LOW_APPS_ADDR A:0x1e1e020
y.create.l HWIO_APPS_SMMU_CB15_TTBR0_LOW_APPS_ADDR A:0x1e1f020
y.create.l HWIO_APPS_SMMU_CB0_TTBR0_HIGH_APPS_ADDR A:0x1e10024
y.create.l HWIO_APPS_SMMU_CB1_TTBR0_HIGH_APPS_ADDR A:0x1e11024
y.create.l HWIO_APPS_SMMU_CB2_TTBR0_HIGH_APPS_ADDR A:0x1e12024
y.create.l HWIO_APPS_SMMU_CB3_TTBR0_HIGH_APPS_ADDR A:0x1e13024
y.create.l HWIO_APPS_SMMU_CB4_TTBR0_HIGH_APPS_ADDR A:0x1e14024
y.create.l HWIO_APPS_SMMU_CB5_TTBR0_HIGH_APPS_ADDR A:0x1e15024
y.create.l HWIO_APPS_SMMU_CB6_TTBR0_HIGH_APPS_ADDR A:0x1e16024
y.create.l HWIO_APPS_SMMU_CB7_TTBR0_HIGH_APPS_ADDR A:0x1e17024
y.create.l HWIO_APPS_SMMU_CB8_TTBR0_HIGH_APPS_ADDR A:0x1e18024
y.create.l HWIO_APPS_SMMU_CB9_TTBR0_HIGH_APPS_ADDR A:0x1e19024
y.create.l HWIO_APPS_SMMU_CB10_TTBR0_HIGH_APPS_ADDR A:0x1e1a024
y.create.l HWIO_APPS_SMMU_CB11_TTBR0_HIGH_APPS_ADDR A:0x1e1b024
y.create.l HWIO_APPS_SMMU_CB12_TTBR0_HIGH_APPS_ADDR A:0x1e1c024
y.create.l HWIO_APPS_SMMU_CB13_TTBR0_HIGH_APPS_ADDR A:0x1e1d024
y.create.l HWIO_APPS_SMMU_CB14_TTBR0_HIGH_APPS_ADDR A:0x1e1e024
y.create.l HWIO_APPS_SMMU_CB15_TTBR0_HIGH_APPS_ADDR A:0x1e1f024
y.create.l HWIO_APPS_SMMU_CB0_TTBR1_LOW_APPS_ADDR A:0x1e10028
y.create.l HWIO_APPS_SMMU_CB1_TTBR1_LOW_APPS_ADDR A:0x1e11028
y.create.l HWIO_APPS_SMMU_CB2_TTBR1_LOW_APPS_ADDR A:0x1e12028
y.create.l HWIO_APPS_SMMU_CB3_TTBR1_LOW_APPS_ADDR A:0x1e13028
y.create.l HWIO_APPS_SMMU_CB4_TTBR1_LOW_APPS_ADDR A:0x1e14028
y.create.l HWIO_APPS_SMMU_CB5_TTBR1_LOW_APPS_ADDR A:0x1e15028
y.create.l HWIO_APPS_SMMU_CB6_TTBR1_LOW_APPS_ADDR A:0x1e16028
y.create.l HWIO_APPS_SMMU_CB7_TTBR1_LOW_APPS_ADDR A:0x1e17028
y.create.l HWIO_APPS_SMMU_CB8_TTBR1_LOW_APPS_ADDR A:0x1e18028
y.create.l HWIO_APPS_SMMU_CB9_TTBR1_LOW_APPS_ADDR A:0x1e19028
y.create.l HWIO_APPS_SMMU_CB10_TTBR1_LOW_APPS_ADDR A:0x1e1a028
y.create.l HWIO_APPS_SMMU_CB11_TTBR1_LOW_APPS_ADDR A:0x1e1b028
y.create.l HWIO_APPS_SMMU_CB12_TTBR1_LOW_APPS_ADDR A:0x1e1c028
y.create.l HWIO_APPS_SMMU_CB13_TTBR1_LOW_APPS_ADDR A:0x1e1d028
y.create.l HWIO_APPS_SMMU_CB14_TTBR1_LOW_APPS_ADDR A:0x1e1e028
y.create.l HWIO_APPS_SMMU_CB15_TTBR1_LOW_APPS_ADDR A:0x1e1f028
y.create.l HWIO_APPS_SMMU_CB0_TTBR1_HIGH_APPS_ADDR A:0x1e1002c
y.create.l HWIO_APPS_SMMU_CB1_TTBR1_HIGH_APPS_ADDR A:0x1e1102c
y.create.l HWIO_APPS_SMMU_CB2_TTBR1_HIGH_APPS_ADDR A:0x1e1202c
y.create.l HWIO_APPS_SMMU_CB3_TTBR1_HIGH_APPS_ADDR A:0x1e1302c
y.create.l HWIO_APPS_SMMU_CB4_TTBR1_HIGH_APPS_ADDR A:0x1e1402c
y.create.l HWIO_APPS_SMMU_CB5_TTBR1_HIGH_APPS_ADDR A:0x1e1502c
y.create.l HWIO_APPS_SMMU_CB6_TTBR1_HIGH_APPS_ADDR A:0x1e1602c
y.create.l HWIO_APPS_SMMU_CB7_TTBR1_HIGH_APPS_ADDR A:0x1e1702c
y.create.l HWIO_APPS_SMMU_CB8_TTBR1_HIGH_APPS_ADDR A:0x1e1802c
y.create.l HWIO_APPS_SMMU_CB9_TTBR1_HIGH_APPS_ADDR A:0x1e1902c
y.create.l HWIO_APPS_SMMU_CB10_TTBR1_HIGH_APPS_ADDR A:0x1e1a02c
y.create.l HWIO_APPS_SMMU_CB11_TTBR1_HIGH_APPS_ADDR A:0x1e1b02c
y.create.l HWIO_APPS_SMMU_CB12_TTBR1_HIGH_APPS_ADDR A:0x1e1c02c
y.create.l HWIO_APPS_SMMU_CB13_TTBR1_HIGH_APPS_ADDR A:0x1e1d02c
y.create.l HWIO_APPS_SMMU_CB14_TTBR1_HIGH_APPS_ADDR A:0x1e1e02c
y.create.l HWIO_APPS_SMMU_CB15_TTBR1_HIGH_APPS_ADDR A:0x1e1f02c
y.create.l HWIO_APPS_SMMU_CB0_TCR_LPAE_APPS_ADDR A:0x1e10030
y.create.l HWIO_APPS_SMMU_CB1_TCR_LPAE_APPS_ADDR A:0x1e11030
y.create.l HWIO_APPS_SMMU_CB2_TCR_LPAE_APPS_ADDR A:0x1e12030
y.create.l HWIO_APPS_SMMU_CB3_TCR_LPAE_APPS_ADDR A:0x1e13030
y.create.l HWIO_APPS_SMMU_CB4_TCR_LPAE_APPS_ADDR A:0x1e14030
y.create.l HWIO_APPS_SMMU_CB5_TCR_LPAE_APPS_ADDR A:0x1e15030
y.create.l HWIO_APPS_SMMU_CB6_TCR_LPAE_APPS_ADDR A:0x1e16030
y.create.l HWIO_APPS_SMMU_CB7_TCR_LPAE_APPS_ADDR A:0x1e17030
y.create.l HWIO_APPS_SMMU_CB8_TCR_LPAE_APPS_ADDR A:0x1e18030
y.create.l HWIO_APPS_SMMU_CB9_TCR_LPAE_APPS_ADDR A:0x1e19030
y.create.l HWIO_APPS_SMMU_CB10_TCR_LPAE_APPS_ADDR A:0x1e1a030
y.create.l HWIO_APPS_SMMU_CB11_TCR_LPAE_APPS_ADDR A:0x1e1b030
y.create.l HWIO_APPS_SMMU_CB12_TCR_LPAE_APPS_ADDR A:0x1e1c030
y.create.l HWIO_APPS_SMMU_CB13_TCR_LPAE_APPS_ADDR A:0x1e1d030
y.create.l HWIO_APPS_SMMU_CB14_TCR_LPAE_APPS_ADDR A:0x1e1e030
y.create.l HWIO_APPS_SMMU_CB15_TCR_LPAE_APPS_ADDR A:0x1e1f030
y.create.l HWIO_APPS_SMMU_CB0_CONTEXTIDR_APPS_ADDR A:0x1e10034
y.create.l HWIO_APPS_SMMU_CB1_CONTEXTIDR_APPS_ADDR A:0x1e11034
y.create.l HWIO_APPS_SMMU_CB2_CONTEXTIDR_APPS_ADDR A:0x1e12034
y.create.l HWIO_APPS_SMMU_CB3_CONTEXTIDR_APPS_ADDR A:0x1e13034
y.create.l HWIO_APPS_SMMU_CB4_CONTEXTIDR_APPS_ADDR A:0x1e14034
y.create.l HWIO_APPS_SMMU_CB5_CONTEXTIDR_APPS_ADDR A:0x1e15034
y.create.l HWIO_APPS_SMMU_CB6_CONTEXTIDR_APPS_ADDR A:0x1e16034
y.create.l HWIO_APPS_SMMU_CB7_CONTEXTIDR_APPS_ADDR A:0x1e17034
y.create.l HWIO_APPS_SMMU_CB8_CONTEXTIDR_APPS_ADDR A:0x1e18034
y.create.l HWIO_APPS_SMMU_CB9_CONTEXTIDR_APPS_ADDR A:0x1e19034
y.create.l HWIO_APPS_SMMU_CB10_CONTEXTIDR_APPS_ADDR A:0x1e1a034
y.create.l HWIO_APPS_SMMU_CB11_CONTEXTIDR_APPS_ADDR A:0x1e1b034
y.create.l HWIO_APPS_SMMU_CB12_CONTEXTIDR_APPS_ADDR A:0x1e1c034
y.create.l HWIO_APPS_SMMU_CB13_CONTEXTIDR_APPS_ADDR A:0x1e1d034
y.create.l HWIO_APPS_SMMU_CB14_CONTEXTIDR_APPS_ADDR A:0x1e1e034
y.create.l HWIO_APPS_SMMU_CB15_CONTEXTIDR_APPS_ADDR A:0x1e1f034
y.create.l HWIO_APPS_SMMU_CB0_PRRR_MAIR0_APPS_ADDR A:0x1e10038
y.create.l HWIO_APPS_SMMU_CB1_PRRR_MAIR0_APPS_ADDR A:0x1e11038
y.create.l HWIO_APPS_SMMU_CB2_PRRR_MAIR0_APPS_ADDR A:0x1e12038
y.create.l HWIO_APPS_SMMU_CB3_PRRR_MAIR0_APPS_ADDR A:0x1e13038
y.create.l HWIO_APPS_SMMU_CB4_PRRR_MAIR0_APPS_ADDR A:0x1e14038
y.create.l HWIO_APPS_SMMU_CB5_PRRR_MAIR0_APPS_ADDR A:0x1e15038
y.create.l HWIO_APPS_SMMU_CB6_PRRR_MAIR0_APPS_ADDR A:0x1e16038
y.create.l HWIO_APPS_SMMU_CB7_PRRR_MAIR0_APPS_ADDR A:0x1e17038
y.create.l HWIO_APPS_SMMU_CB8_PRRR_MAIR0_APPS_ADDR A:0x1e18038
y.create.l HWIO_APPS_SMMU_CB9_PRRR_MAIR0_APPS_ADDR A:0x1e19038
y.create.l HWIO_APPS_SMMU_CB10_PRRR_MAIR0_APPS_ADDR A:0x1e1a038
y.create.l HWIO_APPS_SMMU_CB11_PRRR_MAIR0_APPS_ADDR A:0x1e1b038
y.create.l HWIO_APPS_SMMU_CB12_PRRR_MAIR0_APPS_ADDR A:0x1e1c038
y.create.l HWIO_APPS_SMMU_CB13_PRRR_MAIR0_APPS_ADDR A:0x1e1d038
y.create.l HWIO_APPS_SMMU_CB14_PRRR_MAIR0_APPS_ADDR A:0x1e1e038
y.create.l HWIO_APPS_SMMU_CB15_PRRR_MAIR0_APPS_ADDR A:0x1e1f038
y.create.l HWIO_APPS_SMMU_CB0_NMRR_MAIR1_APPS_ADDR A:0x1e1003c
y.create.l HWIO_APPS_SMMU_CB1_NMRR_MAIR1_APPS_ADDR A:0x1e1103c
y.create.l HWIO_APPS_SMMU_CB2_NMRR_MAIR1_APPS_ADDR A:0x1e1203c
y.create.l HWIO_APPS_SMMU_CB3_NMRR_MAIR1_APPS_ADDR A:0x1e1303c
y.create.l HWIO_APPS_SMMU_CB4_NMRR_MAIR1_APPS_ADDR A:0x1e1403c
y.create.l HWIO_APPS_SMMU_CB5_NMRR_MAIR1_APPS_ADDR A:0x1e1503c
y.create.l HWIO_APPS_SMMU_CB6_NMRR_MAIR1_APPS_ADDR A:0x1e1603c
y.create.l HWIO_APPS_SMMU_CB7_NMRR_MAIR1_APPS_ADDR A:0x1e1703c
y.create.l HWIO_APPS_SMMU_CB8_NMRR_MAIR1_APPS_ADDR A:0x1e1803c
y.create.l HWIO_APPS_SMMU_CB9_NMRR_MAIR1_APPS_ADDR A:0x1e1903c
y.create.l HWIO_APPS_SMMU_CB10_NMRR_MAIR1_APPS_ADDR A:0x1e1a03c
y.create.l HWIO_APPS_SMMU_CB11_NMRR_MAIR1_APPS_ADDR A:0x1e1b03c
y.create.l HWIO_APPS_SMMU_CB12_NMRR_MAIR1_APPS_ADDR A:0x1e1c03c
y.create.l HWIO_APPS_SMMU_CB13_NMRR_MAIR1_APPS_ADDR A:0x1e1d03c
y.create.l HWIO_APPS_SMMU_CB14_NMRR_MAIR1_APPS_ADDR A:0x1e1e03c
y.create.l HWIO_APPS_SMMU_CB15_NMRR_MAIR1_APPS_ADDR A:0x1e1f03c
y.create.l HWIO_APPS_SMMU_CB0_FSR_APPS_ADDR A:0x1e10058
y.create.l HWIO_APPS_SMMU_CB1_FSR_APPS_ADDR A:0x1e11058
y.create.l HWIO_APPS_SMMU_CB2_FSR_APPS_ADDR A:0x1e12058
y.create.l HWIO_APPS_SMMU_CB3_FSR_APPS_ADDR A:0x1e13058
y.create.l HWIO_APPS_SMMU_CB4_FSR_APPS_ADDR A:0x1e14058
y.create.l HWIO_APPS_SMMU_CB5_FSR_APPS_ADDR A:0x1e15058
y.create.l HWIO_APPS_SMMU_CB6_FSR_APPS_ADDR A:0x1e16058
y.create.l HWIO_APPS_SMMU_CB7_FSR_APPS_ADDR A:0x1e17058
y.create.l HWIO_APPS_SMMU_CB8_FSR_APPS_ADDR A:0x1e18058
y.create.l HWIO_APPS_SMMU_CB9_FSR_APPS_ADDR A:0x1e19058
y.create.l HWIO_APPS_SMMU_CB10_FSR_APPS_ADDR A:0x1e1a058
y.create.l HWIO_APPS_SMMU_CB11_FSR_APPS_ADDR A:0x1e1b058
y.create.l HWIO_APPS_SMMU_CB12_FSR_APPS_ADDR A:0x1e1c058
y.create.l HWIO_APPS_SMMU_CB13_FSR_APPS_ADDR A:0x1e1d058
y.create.l HWIO_APPS_SMMU_CB14_FSR_APPS_ADDR A:0x1e1e058
y.create.l HWIO_APPS_SMMU_CB15_FSR_APPS_ADDR A:0x1e1f058
y.create.l HWIO_APPS_SMMU_CB0_FSRRESTORE_APPS_ADDR A:0x1e1005c
y.create.l HWIO_APPS_SMMU_CB1_FSRRESTORE_APPS_ADDR A:0x1e1105c
y.create.l HWIO_APPS_SMMU_CB2_FSRRESTORE_APPS_ADDR A:0x1e1205c
y.create.l HWIO_APPS_SMMU_CB3_FSRRESTORE_APPS_ADDR A:0x1e1305c
y.create.l HWIO_APPS_SMMU_CB4_FSRRESTORE_APPS_ADDR A:0x1e1405c
y.create.l HWIO_APPS_SMMU_CB5_FSRRESTORE_APPS_ADDR A:0x1e1505c
y.create.l HWIO_APPS_SMMU_CB6_FSRRESTORE_APPS_ADDR A:0x1e1605c
y.create.l HWIO_APPS_SMMU_CB7_FSRRESTORE_APPS_ADDR A:0x1e1705c
y.create.l HWIO_APPS_SMMU_CB8_FSRRESTORE_APPS_ADDR A:0x1e1805c
y.create.l HWIO_APPS_SMMU_CB9_FSRRESTORE_APPS_ADDR A:0x1e1905c
y.create.l HWIO_APPS_SMMU_CB10_FSRRESTORE_APPS_ADDR A:0x1e1a05c
y.create.l HWIO_APPS_SMMU_CB11_FSRRESTORE_APPS_ADDR A:0x1e1b05c
y.create.l HWIO_APPS_SMMU_CB12_FSRRESTORE_APPS_ADDR A:0x1e1c05c
y.create.l HWIO_APPS_SMMU_CB13_FSRRESTORE_APPS_ADDR A:0x1e1d05c
y.create.l HWIO_APPS_SMMU_CB14_FSRRESTORE_APPS_ADDR A:0x1e1e05c
y.create.l HWIO_APPS_SMMU_CB15_FSRRESTORE_APPS_ADDR A:0x1e1f05c
y.create.l HWIO_APPS_SMMU_CB0_FAR_LOW_APPS_ADDR A:0x1e10060
y.create.l HWIO_APPS_SMMU_CB1_FAR_LOW_APPS_ADDR A:0x1e11060
y.create.l HWIO_APPS_SMMU_CB2_FAR_LOW_APPS_ADDR A:0x1e12060
y.create.l HWIO_APPS_SMMU_CB3_FAR_LOW_APPS_ADDR A:0x1e13060
y.create.l HWIO_APPS_SMMU_CB4_FAR_LOW_APPS_ADDR A:0x1e14060
y.create.l HWIO_APPS_SMMU_CB5_FAR_LOW_APPS_ADDR A:0x1e15060
y.create.l HWIO_APPS_SMMU_CB6_FAR_LOW_APPS_ADDR A:0x1e16060
y.create.l HWIO_APPS_SMMU_CB7_FAR_LOW_APPS_ADDR A:0x1e17060
y.create.l HWIO_APPS_SMMU_CB8_FAR_LOW_APPS_ADDR A:0x1e18060
y.create.l HWIO_APPS_SMMU_CB9_FAR_LOW_APPS_ADDR A:0x1e19060
y.create.l HWIO_APPS_SMMU_CB10_FAR_LOW_APPS_ADDR A:0x1e1a060
y.create.l HWIO_APPS_SMMU_CB11_FAR_LOW_APPS_ADDR A:0x1e1b060
y.create.l HWIO_APPS_SMMU_CB12_FAR_LOW_APPS_ADDR A:0x1e1c060
y.create.l HWIO_APPS_SMMU_CB13_FAR_LOW_APPS_ADDR A:0x1e1d060
y.create.l HWIO_APPS_SMMU_CB14_FAR_LOW_APPS_ADDR A:0x1e1e060
y.create.l HWIO_APPS_SMMU_CB15_FAR_LOW_APPS_ADDR A:0x1e1f060
y.create.l HWIO_APPS_SMMU_CB0_FAR_HIGH_APPS_ADDR A:0x1e10064
y.create.l HWIO_APPS_SMMU_CB1_FAR_HIGH_APPS_ADDR A:0x1e11064
y.create.l HWIO_APPS_SMMU_CB2_FAR_HIGH_APPS_ADDR A:0x1e12064
y.create.l HWIO_APPS_SMMU_CB3_FAR_HIGH_APPS_ADDR A:0x1e13064
y.create.l HWIO_APPS_SMMU_CB4_FAR_HIGH_APPS_ADDR A:0x1e14064
y.create.l HWIO_APPS_SMMU_CB5_FAR_HIGH_APPS_ADDR A:0x1e15064
y.create.l HWIO_APPS_SMMU_CB6_FAR_HIGH_APPS_ADDR A:0x1e16064
y.create.l HWIO_APPS_SMMU_CB7_FAR_HIGH_APPS_ADDR A:0x1e17064
y.create.l HWIO_APPS_SMMU_CB8_FAR_HIGH_APPS_ADDR A:0x1e18064
y.create.l HWIO_APPS_SMMU_CB9_FAR_HIGH_APPS_ADDR A:0x1e19064
y.create.l HWIO_APPS_SMMU_CB10_FAR_HIGH_APPS_ADDR A:0x1e1a064
y.create.l HWIO_APPS_SMMU_CB11_FAR_HIGH_APPS_ADDR A:0x1e1b064
y.create.l HWIO_APPS_SMMU_CB12_FAR_HIGH_APPS_ADDR A:0x1e1c064
y.create.l HWIO_APPS_SMMU_CB13_FAR_HIGH_APPS_ADDR A:0x1e1d064
y.create.l HWIO_APPS_SMMU_CB14_FAR_HIGH_APPS_ADDR A:0x1e1e064
y.create.l HWIO_APPS_SMMU_CB15_FAR_HIGH_APPS_ADDR A:0x1e1f064
y.create.l HWIO_APPS_SMMU_CB0_FSYNR0_APPS_ADDR A:0x1e10068
y.create.l HWIO_APPS_SMMU_CB1_FSYNR0_APPS_ADDR A:0x1e11068
y.create.l HWIO_APPS_SMMU_CB2_FSYNR0_APPS_ADDR A:0x1e12068
y.create.l HWIO_APPS_SMMU_CB3_FSYNR0_APPS_ADDR A:0x1e13068
y.create.l HWIO_APPS_SMMU_CB4_FSYNR0_APPS_ADDR A:0x1e14068
y.create.l HWIO_APPS_SMMU_CB5_FSYNR0_APPS_ADDR A:0x1e15068
y.create.l HWIO_APPS_SMMU_CB6_FSYNR0_APPS_ADDR A:0x1e16068
y.create.l HWIO_APPS_SMMU_CB7_FSYNR0_APPS_ADDR A:0x1e17068
y.create.l HWIO_APPS_SMMU_CB8_FSYNR0_APPS_ADDR A:0x1e18068
y.create.l HWIO_APPS_SMMU_CB9_FSYNR0_APPS_ADDR A:0x1e19068
y.create.l HWIO_APPS_SMMU_CB10_FSYNR0_APPS_ADDR A:0x1e1a068
y.create.l HWIO_APPS_SMMU_CB11_FSYNR0_APPS_ADDR A:0x1e1b068
y.create.l HWIO_APPS_SMMU_CB12_FSYNR0_APPS_ADDR A:0x1e1c068
y.create.l HWIO_APPS_SMMU_CB13_FSYNR0_APPS_ADDR A:0x1e1d068
y.create.l HWIO_APPS_SMMU_CB14_FSYNR0_APPS_ADDR A:0x1e1e068
y.create.l HWIO_APPS_SMMU_CB15_FSYNR0_APPS_ADDR A:0x1e1f068
y.create.l HWIO_APPS_SMMU_CB0_IPAFAR_LOW_APPS_ADDR A:0x1e10070
y.create.l HWIO_APPS_SMMU_CB1_IPAFAR_LOW_APPS_ADDR A:0x1e11070
y.create.l HWIO_APPS_SMMU_CB2_IPAFAR_LOW_APPS_ADDR A:0x1e12070
y.create.l HWIO_APPS_SMMU_CB3_IPAFAR_LOW_APPS_ADDR A:0x1e13070
y.create.l HWIO_APPS_SMMU_CB4_IPAFAR_LOW_APPS_ADDR A:0x1e14070
y.create.l HWIO_APPS_SMMU_CB5_IPAFAR_LOW_APPS_ADDR A:0x1e15070
y.create.l HWIO_APPS_SMMU_CB6_IPAFAR_LOW_APPS_ADDR A:0x1e16070
y.create.l HWIO_APPS_SMMU_CB7_IPAFAR_LOW_APPS_ADDR A:0x1e17070
y.create.l HWIO_APPS_SMMU_CB8_IPAFAR_LOW_APPS_ADDR A:0x1e18070
y.create.l HWIO_APPS_SMMU_CB9_IPAFAR_LOW_APPS_ADDR A:0x1e19070
y.create.l HWIO_APPS_SMMU_CB10_IPAFAR_LOW_APPS_ADDR A:0x1e1a070
y.create.l HWIO_APPS_SMMU_CB11_IPAFAR_LOW_APPS_ADDR A:0x1e1b070
y.create.l HWIO_APPS_SMMU_CB12_IPAFAR_LOW_APPS_ADDR A:0x1e1c070
y.create.l HWIO_APPS_SMMU_CB13_IPAFAR_LOW_APPS_ADDR A:0x1e1d070
y.create.l HWIO_APPS_SMMU_CB14_IPAFAR_LOW_APPS_ADDR A:0x1e1e070
y.create.l HWIO_APPS_SMMU_CB15_IPAFAR_LOW_APPS_ADDR A:0x1e1f070
y.create.l HWIO_APPS_SMMU_CB0_IPAFAR_HIGH_APPS_ADDR A:0x1e10074
y.create.l HWIO_APPS_SMMU_CB1_IPAFAR_HIGH_APPS_ADDR A:0x1e11074
y.create.l HWIO_APPS_SMMU_CB2_IPAFAR_HIGH_APPS_ADDR A:0x1e12074
y.create.l HWIO_APPS_SMMU_CB3_IPAFAR_HIGH_APPS_ADDR A:0x1e13074
y.create.l HWIO_APPS_SMMU_CB4_IPAFAR_HIGH_APPS_ADDR A:0x1e14074
y.create.l HWIO_APPS_SMMU_CB5_IPAFAR_HIGH_APPS_ADDR A:0x1e15074
y.create.l HWIO_APPS_SMMU_CB6_IPAFAR_HIGH_APPS_ADDR A:0x1e16074
y.create.l HWIO_APPS_SMMU_CB7_IPAFAR_HIGH_APPS_ADDR A:0x1e17074
y.create.l HWIO_APPS_SMMU_CB8_IPAFAR_HIGH_APPS_ADDR A:0x1e18074
y.create.l HWIO_APPS_SMMU_CB9_IPAFAR_HIGH_APPS_ADDR A:0x1e19074
y.create.l HWIO_APPS_SMMU_CB10_IPAFAR_HIGH_APPS_ADDR A:0x1e1a074
y.create.l HWIO_APPS_SMMU_CB11_IPAFAR_HIGH_APPS_ADDR A:0x1e1b074
y.create.l HWIO_APPS_SMMU_CB12_IPAFAR_HIGH_APPS_ADDR A:0x1e1c074
y.create.l HWIO_APPS_SMMU_CB13_IPAFAR_HIGH_APPS_ADDR A:0x1e1d074
y.create.l HWIO_APPS_SMMU_CB14_IPAFAR_HIGH_APPS_ADDR A:0x1e1e074
y.create.l HWIO_APPS_SMMU_CB15_IPAFAR_HIGH_APPS_ADDR A:0x1e1f074
y.create.l HWIO_APPS_SMMU_CB0_TLBIVA_LOW_APPS_ADDR A:0x1e10600
y.create.l HWIO_APPS_SMMU_CB1_TLBIVA_LOW_APPS_ADDR A:0x1e11600
y.create.l HWIO_APPS_SMMU_CB2_TLBIVA_LOW_APPS_ADDR A:0x1e12600
y.create.l HWIO_APPS_SMMU_CB3_TLBIVA_LOW_APPS_ADDR A:0x1e13600
y.create.l HWIO_APPS_SMMU_CB4_TLBIVA_LOW_APPS_ADDR A:0x1e14600
y.create.l HWIO_APPS_SMMU_CB5_TLBIVA_LOW_APPS_ADDR A:0x1e15600
y.create.l HWIO_APPS_SMMU_CB6_TLBIVA_LOW_APPS_ADDR A:0x1e16600
y.create.l HWIO_APPS_SMMU_CB7_TLBIVA_LOW_APPS_ADDR A:0x1e17600
y.create.l HWIO_APPS_SMMU_CB8_TLBIVA_LOW_APPS_ADDR A:0x1e18600
y.create.l HWIO_APPS_SMMU_CB9_TLBIVA_LOW_APPS_ADDR A:0x1e19600
y.create.l HWIO_APPS_SMMU_CB10_TLBIVA_LOW_APPS_ADDR A:0x1e1a600
y.create.l HWIO_APPS_SMMU_CB11_TLBIVA_LOW_APPS_ADDR A:0x1e1b600
y.create.l HWIO_APPS_SMMU_CB12_TLBIVA_LOW_APPS_ADDR A:0x1e1c600
y.create.l HWIO_APPS_SMMU_CB13_TLBIVA_LOW_APPS_ADDR A:0x1e1d600
y.create.l HWIO_APPS_SMMU_CB14_TLBIVA_LOW_APPS_ADDR A:0x1e1e600
y.create.l HWIO_APPS_SMMU_CB15_TLBIVA_LOW_APPS_ADDR A:0x1e1f600
y.create.l HWIO_APPS_SMMU_CB0_TLBIVA_HIGH_APPS_ADDR A:0x1e10604
y.create.l HWIO_APPS_SMMU_CB1_TLBIVA_HIGH_APPS_ADDR A:0x1e11604
y.create.l HWIO_APPS_SMMU_CB2_TLBIVA_HIGH_APPS_ADDR A:0x1e12604
y.create.l HWIO_APPS_SMMU_CB3_TLBIVA_HIGH_APPS_ADDR A:0x1e13604
y.create.l HWIO_APPS_SMMU_CB4_TLBIVA_HIGH_APPS_ADDR A:0x1e14604
y.create.l HWIO_APPS_SMMU_CB5_TLBIVA_HIGH_APPS_ADDR A:0x1e15604
y.create.l HWIO_APPS_SMMU_CB6_TLBIVA_HIGH_APPS_ADDR A:0x1e16604
y.create.l HWIO_APPS_SMMU_CB7_TLBIVA_HIGH_APPS_ADDR A:0x1e17604
y.create.l HWIO_APPS_SMMU_CB8_TLBIVA_HIGH_APPS_ADDR A:0x1e18604
y.create.l HWIO_APPS_SMMU_CB9_TLBIVA_HIGH_APPS_ADDR A:0x1e19604
y.create.l HWIO_APPS_SMMU_CB10_TLBIVA_HIGH_APPS_ADDR A:0x1e1a604
y.create.l HWIO_APPS_SMMU_CB11_TLBIVA_HIGH_APPS_ADDR A:0x1e1b604
y.create.l HWIO_APPS_SMMU_CB12_TLBIVA_HIGH_APPS_ADDR A:0x1e1c604
y.create.l HWIO_APPS_SMMU_CB13_TLBIVA_HIGH_APPS_ADDR A:0x1e1d604
y.create.l HWIO_APPS_SMMU_CB14_TLBIVA_HIGH_APPS_ADDR A:0x1e1e604
y.create.l HWIO_APPS_SMMU_CB15_TLBIVA_HIGH_APPS_ADDR A:0x1e1f604
y.create.l HWIO_APPS_SMMU_CB0_TLBIVAA_LOW_APPS_ADDR A:0x1e10608
y.create.l HWIO_APPS_SMMU_CB1_TLBIVAA_LOW_APPS_ADDR A:0x1e11608
y.create.l HWIO_APPS_SMMU_CB2_TLBIVAA_LOW_APPS_ADDR A:0x1e12608
y.create.l HWIO_APPS_SMMU_CB3_TLBIVAA_LOW_APPS_ADDR A:0x1e13608
y.create.l HWIO_APPS_SMMU_CB4_TLBIVAA_LOW_APPS_ADDR A:0x1e14608
y.create.l HWIO_APPS_SMMU_CB5_TLBIVAA_LOW_APPS_ADDR A:0x1e15608
y.create.l HWIO_APPS_SMMU_CB6_TLBIVAA_LOW_APPS_ADDR A:0x1e16608
y.create.l HWIO_APPS_SMMU_CB7_TLBIVAA_LOW_APPS_ADDR A:0x1e17608
y.create.l HWIO_APPS_SMMU_CB8_TLBIVAA_LOW_APPS_ADDR A:0x1e18608
y.create.l HWIO_APPS_SMMU_CB9_TLBIVAA_LOW_APPS_ADDR A:0x1e19608
y.create.l HWIO_APPS_SMMU_CB10_TLBIVAA_LOW_APPS_ADDR A:0x1e1a608
y.create.l HWIO_APPS_SMMU_CB11_TLBIVAA_LOW_APPS_ADDR A:0x1e1b608
y.create.l HWIO_APPS_SMMU_CB12_TLBIVAA_LOW_APPS_ADDR A:0x1e1c608
y.create.l HWIO_APPS_SMMU_CB13_TLBIVAA_LOW_APPS_ADDR A:0x1e1d608
y.create.l HWIO_APPS_SMMU_CB14_TLBIVAA_LOW_APPS_ADDR A:0x1e1e608
y.create.l HWIO_APPS_SMMU_CB15_TLBIVAA_LOW_APPS_ADDR A:0x1e1f608
y.create.l HWIO_APPS_SMMU_CB0_TLBIVAA_HIGH_APPS_ADDR A:0x1e1060c
y.create.l HWIO_APPS_SMMU_CB1_TLBIVAA_HIGH_APPS_ADDR A:0x1e1160c
y.create.l HWIO_APPS_SMMU_CB2_TLBIVAA_HIGH_APPS_ADDR A:0x1e1260c
y.create.l HWIO_APPS_SMMU_CB3_TLBIVAA_HIGH_APPS_ADDR A:0x1e1360c
y.create.l HWIO_APPS_SMMU_CB4_TLBIVAA_HIGH_APPS_ADDR A:0x1e1460c
y.create.l HWIO_APPS_SMMU_CB5_TLBIVAA_HIGH_APPS_ADDR A:0x1e1560c
y.create.l HWIO_APPS_SMMU_CB6_TLBIVAA_HIGH_APPS_ADDR A:0x1e1660c
y.create.l HWIO_APPS_SMMU_CB7_TLBIVAA_HIGH_APPS_ADDR A:0x1e1760c
y.create.l HWIO_APPS_SMMU_CB8_TLBIVAA_HIGH_APPS_ADDR A:0x1e1860c
y.create.l HWIO_APPS_SMMU_CB9_TLBIVAA_HIGH_APPS_ADDR A:0x1e1960c
y.create.l HWIO_APPS_SMMU_CB10_TLBIVAA_HIGH_APPS_ADDR A:0x1e1a60c
y.create.l HWIO_APPS_SMMU_CB11_TLBIVAA_HIGH_APPS_ADDR A:0x1e1b60c
y.create.l HWIO_APPS_SMMU_CB12_TLBIVAA_HIGH_APPS_ADDR A:0x1e1c60c
y.create.l HWIO_APPS_SMMU_CB13_TLBIVAA_HIGH_APPS_ADDR A:0x1e1d60c
y.create.l HWIO_APPS_SMMU_CB14_TLBIVAA_HIGH_APPS_ADDR A:0x1e1e60c
y.create.l HWIO_APPS_SMMU_CB15_TLBIVAA_HIGH_APPS_ADDR A:0x1e1f60c
y.create.l HWIO_APPS_SMMU_CB0_TLBIASID_APPS_ADDR A:0x1e10610
y.create.l HWIO_APPS_SMMU_CB1_TLBIASID_APPS_ADDR A:0x1e11610
y.create.l HWIO_APPS_SMMU_CB2_TLBIASID_APPS_ADDR A:0x1e12610
y.create.l HWIO_APPS_SMMU_CB3_TLBIASID_APPS_ADDR A:0x1e13610
y.create.l HWIO_APPS_SMMU_CB4_TLBIASID_APPS_ADDR A:0x1e14610
y.create.l HWIO_APPS_SMMU_CB5_TLBIASID_APPS_ADDR A:0x1e15610
y.create.l HWIO_APPS_SMMU_CB6_TLBIASID_APPS_ADDR A:0x1e16610
y.create.l HWIO_APPS_SMMU_CB7_TLBIASID_APPS_ADDR A:0x1e17610
y.create.l HWIO_APPS_SMMU_CB8_TLBIASID_APPS_ADDR A:0x1e18610
y.create.l HWIO_APPS_SMMU_CB9_TLBIASID_APPS_ADDR A:0x1e19610
y.create.l HWIO_APPS_SMMU_CB10_TLBIASID_APPS_ADDR A:0x1e1a610
y.create.l HWIO_APPS_SMMU_CB11_TLBIASID_APPS_ADDR A:0x1e1b610
y.create.l HWIO_APPS_SMMU_CB12_TLBIASID_APPS_ADDR A:0x1e1c610
y.create.l HWIO_APPS_SMMU_CB13_TLBIASID_APPS_ADDR A:0x1e1d610
y.create.l HWIO_APPS_SMMU_CB14_TLBIASID_APPS_ADDR A:0x1e1e610
y.create.l HWIO_APPS_SMMU_CB15_TLBIASID_APPS_ADDR A:0x1e1f610
y.create.l HWIO_APPS_SMMU_CB0_TLBIALL_APPS_ADDR A:0x1e10618
y.create.l HWIO_APPS_SMMU_CB1_TLBIALL_APPS_ADDR A:0x1e11618
y.create.l HWIO_APPS_SMMU_CB2_TLBIALL_APPS_ADDR A:0x1e12618
y.create.l HWIO_APPS_SMMU_CB3_TLBIALL_APPS_ADDR A:0x1e13618
y.create.l HWIO_APPS_SMMU_CB4_TLBIALL_APPS_ADDR A:0x1e14618
y.create.l HWIO_APPS_SMMU_CB5_TLBIALL_APPS_ADDR A:0x1e15618
y.create.l HWIO_APPS_SMMU_CB6_TLBIALL_APPS_ADDR A:0x1e16618
y.create.l HWIO_APPS_SMMU_CB7_TLBIALL_APPS_ADDR A:0x1e17618
y.create.l HWIO_APPS_SMMU_CB8_TLBIALL_APPS_ADDR A:0x1e18618
y.create.l HWIO_APPS_SMMU_CB9_TLBIALL_APPS_ADDR A:0x1e19618
y.create.l HWIO_APPS_SMMU_CB10_TLBIALL_APPS_ADDR A:0x1e1a618
y.create.l HWIO_APPS_SMMU_CB11_TLBIALL_APPS_ADDR A:0x1e1b618
y.create.l HWIO_APPS_SMMU_CB12_TLBIALL_APPS_ADDR A:0x1e1c618
y.create.l HWIO_APPS_SMMU_CB13_TLBIALL_APPS_ADDR A:0x1e1d618
y.create.l HWIO_APPS_SMMU_CB14_TLBIALL_APPS_ADDR A:0x1e1e618
y.create.l HWIO_APPS_SMMU_CB15_TLBIALL_APPS_ADDR A:0x1e1f618
y.create.l HWIO_APPS_SMMU_CB0_TLBIVAL_LOW_APPS_ADDR A:0x1e10620
y.create.l HWIO_APPS_SMMU_CB1_TLBIVAL_LOW_APPS_ADDR A:0x1e11620
y.create.l HWIO_APPS_SMMU_CB2_TLBIVAL_LOW_APPS_ADDR A:0x1e12620
y.create.l HWIO_APPS_SMMU_CB3_TLBIVAL_LOW_APPS_ADDR A:0x1e13620
y.create.l HWIO_APPS_SMMU_CB4_TLBIVAL_LOW_APPS_ADDR A:0x1e14620
y.create.l HWIO_APPS_SMMU_CB5_TLBIVAL_LOW_APPS_ADDR A:0x1e15620
y.create.l HWIO_APPS_SMMU_CB6_TLBIVAL_LOW_APPS_ADDR A:0x1e16620
y.create.l HWIO_APPS_SMMU_CB7_TLBIVAL_LOW_APPS_ADDR A:0x1e17620
y.create.l HWIO_APPS_SMMU_CB8_TLBIVAL_LOW_APPS_ADDR A:0x1e18620
y.create.l HWIO_APPS_SMMU_CB9_TLBIVAL_LOW_APPS_ADDR A:0x1e19620
y.create.l HWIO_APPS_SMMU_CB10_TLBIVAL_LOW_APPS_ADDR A:0x1e1a620
y.create.l HWIO_APPS_SMMU_CB11_TLBIVAL_LOW_APPS_ADDR A:0x1e1b620
y.create.l HWIO_APPS_SMMU_CB12_TLBIVAL_LOW_APPS_ADDR A:0x1e1c620
y.create.l HWIO_APPS_SMMU_CB13_TLBIVAL_LOW_APPS_ADDR A:0x1e1d620
y.create.l HWIO_APPS_SMMU_CB14_TLBIVAL_LOW_APPS_ADDR A:0x1e1e620
y.create.l HWIO_APPS_SMMU_CB15_TLBIVAL_LOW_APPS_ADDR A:0x1e1f620
y.create.l HWIO_APPS_SMMU_CB0_TLBIVAL_HIGH_APPS_ADDR A:0x1e10624
y.create.l HWIO_APPS_SMMU_CB1_TLBIVAL_HIGH_APPS_ADDR A:0x1e11624
y.create.l HWIO_APPS_SMMU_CB2_TLBIVAL_HIGH_APPS_ADDR A:0x1e12624
y.create.l HWIO_APPS_SMMU_CB3_TLBIVAL_HIGH_APPS_ADDR A:0x1e13624
y.create.l HWIO_APPS_SMMU_CB4_TLBIVAL_HIGH_APPS_ADDR A:0x1e14624
y.create.l HWIO_APPS_SMMU_CB5_TLBIVAL_HIGH_APPS_ADDR A:0x1e15624
y.create.l HWIO_APPS_SMMU_CB6_TLBIVAL_HIGH_APPS_ADDR A:0x1e16624
y.create.l HWIO_APPS_SMMU_CB7_TLBIVAL_HIGH_APPS_ADDR A:0x1e17624
y.create.l HWIO_APPS_SMMU_CB8_TLBIVAL_HIGH_APPS_ADDR A:0x1e18624
y.create.l HWIO_APPS_SMMU_CB9_TLBIVAL_HIGH_APPS_ADDR A:0x1e19624
y.create.l HWIO_APPS_SMMU_CB10_TLBIVAL_HIGH_APPS_ADDR A:0x1e1a624
y.create.l HWIO_APPS_SMMU_CB11_TLBIVAL_HIGH_APPS_ADDR A:0x1e1b624
y.create.l HWIO_APPS_SMMU_CB12_TLBIVAL_HIGH_APPS_ADDR A:0x1e1c624
y.create.l HWIO_APPS_SMMU_CB13_TLBIVAL_HIGH_APPS_ADDR A:0x1e1d624
y.create.l HWIO_APPS_SMMU_CB14_TLBIVAL_HIGH_APPS_ADDR A:0x1e1e624
y.create.l HWIO_APPS_SMMU_CB15_TLBIVAL_HIGH_APPS_ADDR A:0x1e1f624
y.create.l HWIO_APPS_SMMU_CB0_TLBIVAAL_LOW_APPS_ADDR A:0x1e10628
y.create.l HWIO_APPS_SMMU_CB1_TLBIVAAL_LOW_APPS_ADDR A:0x1e11628
y.create.l HWIO_APPS_SMMU_CB2_TLBIVAAL_LOW_APPS_ADDR A:0x1e12628
y.create.l HWIO_APPS_SMMU_CB3_TLBIVAAL_LOW_APPS_ADDR A:0x1e13628
y.create.l HWIO_APPS_SMMU_CB4_TLBIVAAL_LOW_APPS_ADDR A:0x1e14628
y.create.l HWIO_APPS_SMMU_CB5_TLBIVAAL_LOW_APPS_ADDR A:0x1e15628
y.create.l HWIO_APPS_SMMU_CB6_TLBIVAAL_LOW_APPS_ADDR A:0x1e16628
y.create.l HWIO_APPS_SMMU_CB7_TLBIVAAL_LOW_APPS_ADDR A:0x1e17628
y.create.l HWIO_APPS_SMMU_CB8_TLBIVAAL_LOW_APPS_ADDR A:0x1e18628
y.create.l HWIO_APPS_SMMU_CB9_TLBIVAAL_LOW_APPS_ADDR A:0x1e19628
y.create.l HWIO_APPS_SMMU_CB10_TLBIVAAL_LOW_APPS_ADDR A:0x1e1a628
y.create.l HWIO_APPS_SMMU_CB11_TLBIVAAL_LOW_APPS_ADDR A:0x1e1b628
y.create.l HWIO_APPS_SMMU_CB12_TLBIVAAL_LOW_APPS_ADDR A:0x1e1c628
y.create.l HWIO_APPS_SMMU_CB13_TLBIVAAL_LOW_APPS_ADDR A:0x1e1d628
y.create.l HWIO_APPS_SMMU_CB14_TLBIVAAL_LOW_APPS_ADDR A:0x1e1e628
y.create.l HWIO_APPS_SMMU_CB15_TLBIVAAL_LOW_APPS_ADDR A:0x1e1f628
y.create.l HWIO_APPS_SMMU_CB0_TLBIVAAL_HIGH_APPS_ADDR A:0x1e1062c
y.create.l HWIO_APPS_SMMU_CB1_TLBIVAAL_HIGH_APPS_ADDR A:0x1e1162c
y.create.l HWIO_APPS_SMMU_CB2_TLBIVAAL_HIGH_APPS_ADDR A:0x1e1262c
y.create.l HWIO_APPS_SMMU_CB3_TLBIVAAL_HIGH_APPS_ADDR A:0x1e1362c
y.create.l HWIO_APPS_SMMU_CB4_TLBIVAAL_HIGH_APPS_ADDR A:0x1e1462c
y.create.l HWIO_APPS_SMMU_CB5_TLBIVAAL_HIGH_APPS_ADDR A:0x1e1562c
y.create.l HWIO_APPS_SMMU_CB6_TLBIVAAL_HIGH_APPS_ADDR A:0x1e1662c
y.create.l HWIO_APPS_SMMU_CB7_TLBIVAAL_HIGH_APPS_ADDR A:0x1e1762c
y.create.l HWIO_APPS_SMMU_CB8_TLBIVAAL_HIGH_APPS_ADDR A:0x1e1862c
y.create.l HWIO_APPS_SMMU_CB9_TLBIVAAL_HIGH_APPS_ADDR A:0x1e1962c
y.create.l HWIO_APPS_SMMU_CB10_TLBIVAAL_HIGH_APPS_ADDR A:0x1e1a62c
y.create.l HWIO_APPS_SMMU_CB11_TLBIVAAL_HIGH_APPS_ADDR A:0x1e1b62c
y.create.l HWIO_APPS_SMMU_CB12_TLBIVAAL_HIGH_APPS_ADDR A:0x1e1c62c
y.create.l HWIO_APPS_SMMU_CB13_TLBIVAAL_HIGH_APPS_ADDR A:0x1e1d62c
y.create.l HWIO_APPS_SMMU_CB14_TLBIVAAL_HIGH_APPS_ADDR A:0x1e1e62c
y.create.l HWIO_APPS_SMMU_CB15_TLBIVAAL_HIGH_APPS_ADDR A:0x1e1f62c
y.create.l HWIO_APPS_SMMU_CB0_TLBIIPAS2_LOW_APPS_ADDR A:0x1e10630
y.create.l HWIO_APPS_SMMU_CB1_TLBIIPAS2_LOW_APPS_ADDR A:0x1e11630
y.create.l HWIO_APPS_SMMU_CB2_TLBIIPAS2_LOW_APPS_ADDR A:0x1e12630
y.create.l HWIO_APPS_SMMU_CB3_TLBIIPAS2_LOW_APPS_ADDR A:0x1e13630
y.create.l HWIO_APPS_SMMU_CB4_TLBIIPAS2_LOW_APPS_ADDR A:0x1e14630
y.create.l HWIO_APPS_SMMU_CB5_TLBIIPAS2_LOW_APPS_ADDR A:0x1e15630
y.create.l HWIO_APPS_SMMU_CB6_TLBIIPAS2_LOW_APPS_ADDR A:0x1e16630
y.create.l HWIO_APPS_SMMU_CB7_TLBIIPAS2_LOW_APPS_ADDR A:0x1e17630
y.create.l HWIO_APPS_SMMU_CB8_TLBIIPAS2_LOW_APPS_ADDR A:0x1e18630
y.create.l HWIO_APPS_SMMU_CB9_TLBIIPAS2_LOW_APPS_ADDR A:0x1e19630
y.create.l HWIO_APPS_SMMU_CB10_TLBIIPAS2_LOW_APPS_ADDR A:0x1e1a630
y.create.l HWIO_APPS_SMMU_CB11_TLBIIPAS2_LOW_APPS_ADDR A:0x1e1b630
y.create.l HWIO_APPS_SMMU_CB12_TLBIIPAS2_LOW_APPS_ADDR A:0x1e1c630
y.create.l HWIO_APPS_SMMU_CB13_TLBIIPAS2_LOW_APPS_ADDR A:0x1e1d630
y.create.l HWIO_APPS_SMMU_CB14_TLBIIPAS2_LOW_APPS_ADDR A:0x1e1e630
y.create.l HWIO_APPS_SMMU_CB15_TLBIIPAS2_LOW_APPS_ADDR A:0x1e1f630
y.create.l HWIO_APPS_SMMU_CB0_TLBIIPAS2_HIGH_APPS_ADDR A:0x1e10634
y.create.l HWIO_APPS_SMMU_CB1_TLBIIPAS2_HIGH_APPS_ADDR A:0x1e11634
y.create.l HWIO_APPS_SMMU_CB2_TLBIIPAS2_HIGH_APPS_ADDR A:0x1e12634
y.create.l HWIO_APPS_SMMU_CB3_TLBIIPAS2_HIGH_APPS_ADDR A:0x1e13634
y.create.l HWIO_APPS_SMMU_CB4_TLBIIPAS2_HIGH_APPS_ADDR A:0x1e14634
y.create.l HWIO_APPS_SMMU_CB5_TLBIIPAS2_HIGH_APPS_ADDR A:0x1e15634
y.create.l HWIO_APPS_SMMU_CB6_TLBIIPAS2_HIGH_APPS_ADDR A:0x1e16634
y.create.l HWIO_APPS_SMMU_CB7_TLBIIPAS2_HIGH_APPS_ADDR A:0x1e17634
y.create.l HWIO_APPS_SMMU_CB8_TLBIIPAS2_HIGH_APPS_ADDR A:0x1e18634
y.create.l HWIO_APPS_SMMU_CB9_TLBIIPAS2_HIGH_APPS_ADDR A:0x1e19634
y.create.l HWIO_APPS_SMMU_CB10_TLBIIPAS2_HIGH_APPS_ADDR A:0x1e1a634
y.create.l HWIO_APPS_SMMU_CB11_TLBIIPAS2_HIGH_APPS_ADDR A:0x1e1b634
y.create.l HWIO_APPS_SMMU_CB12_TLBIIPAS2_HIGH_APPS_ADDR A:0x1e1c634
y.create.l HWIO_APPS_SMMU_CB13_TLBIIPAS2_HIGH_APPS_ADDR A:0x1e1d634
y.create.l HWIO_APPS_SMMU_CB14_TLBIIPAS2_HIGH_APPS_ADDR A:0x1e1e634
y.create.l HWIO_APPS_SMMU_CB15_TLBIIPAS2_HIGH_APPS_ADDR A:0x1e1f634
y.create.l HWIO_APPS_SMMU_CB0_TLBIIPAS2L_LOW_APPS_ADDR A:0x1e10638
y.create.l HWIO_APPS_SMMU_CB1_TLBIIPAS2L_LOW_APPS_ADDR A:0x1e11638
y.create.l HWIO_APPS_SMMU_CB2_TLBIIPAS2L_LOW_APPS_ADDR A:0x1e12638
y.create.l HWIO_APPS_SMMU_CB3_TLBIIPAS2L_LOW_APPS_ADDR A:0x1e13638
y.create.l HWIO_APPS_SMMU_CB4_TLBIIPAS2L_LOW_APPS_ADDR A:0x1e14638
y.create.l HWIO_APPS_SMMU_CB5_TLBIIPAS2L_LOW_APPS_ADDR A:0x1e15638
y.create.l HWIO_APPS_SMMU_CB6_TLBIIPAS2L_LOW_APPS_ADDR A:0x1e16638
y.create.l HWIO_APPS_SMMU_CB7_TLBIIPAS2L_LOW_APPS_ADDR A:0x1e17638
y.create.l HWIO_APPS_SMMU_CB8_TLBIIPAS2L_LOW_APPS_ADDR A:0x1e18638
y.create.l HWIO_APPS_SMMU_CB9_TLBIIPAS2L_LOW_APPS_ADDR A:0x1e19638
y.create.l HWIO_APPS_SMMU_CB10_TLBIIPAS2L_LOW_APPS_ADDR A:0x1e1a638
y.create.l HWIO_APPS_SMMU_CB11_TLBIIPAS2L_LOW_APPS_ADDR A:0x1e1b638
y.create.l HWIO_APPS_SMMU_CB12_TLBIIPAS2L_LOW_APPS_ADDR A:0x1e1c638
y.create.l HWIO_APPS_SMMU_CB13_TLBIIPAS2L_LOW_APPS_ADDR A:0x1e1d638
y.create.l HWIO_APPS_SMMU_CB14_TLBIIPAS2L_LOW_APPS_ADDR A:0x1e1e638
y.create.l HWIO_APPS_SMMU_CB15_TLBIIPAS2L_LOW_APPS_ADDR A:0x1e1f638
y.create.l HWIO_APPS_SMMU_CB0_TLBIIPAS2L_HIGH_APPS_ADDR A:0x1e1063c
y.create.l HWIO_APPS_SMMU_CB1_TLBIIPAS2L_HIGH_APPS_ADDR A:0x1e1163c
y.create.l HWIO_APPS_SMMU_CB2_TLBIIPAS2L_HIGH_APPS_ADDR A:0x1e1263c
y.create.l HWIO_APPS_SMMU_CB3_TLBIIPAS2L_HIGH_APPS_ADDR A:0x1e1363c
y.create.l HWIO_APPS_SMMU_CB4_TLBIIPAS2L_HIGH_APPS_ADDR A:0x1e1463c
y.create.l HWIO_APPS_SMMU_CB5_TLBIIPAS2L_HIGH_APPS_ADDR A:0x1e1563c
y.create.l HWIO_APPS_SMMU_CB6_TLBIIPAS2L_HIGH_APPS_ADDR A:0x1e1663c
y.create.l HWIO_APPS_SMMU_CB7_TLBIIPAS2L_HIGH_APPS_ADDR A:0x1e1763c
y.create.l HWIO_APPS_SMMU_CB8_TLBIIPAS2L_HIGH_APPS_ADDR A:0x1e1863c
y.create.l HWIO_APPS_SMMU_CB9_TLBIIPAS2L_HIGH_APPS_ADDR A:0x1e1963c
y.create.l HWIO_APPS_SMMU_CB10_TLBIIPAS2L_HIGH_APPS_ADDR A:0x1e1a63c
y.create.l HWIO_APPS_SMMU_CB11_TLBIIPAS2L_HIGH_APPS_ADDR A:0x1e1b63c
y.create.l HWIO_APPS_SMMU_CB12_TLBIIPAS2L_HIGH_APPS_ADDR A:0x1e1c63c
y.create.l HWIO_APPS_SMMU_CB13_TLBIIPAS2L_HIGH_APPS_ADDR A:0x1e1d63c
y.create.l HWIO_APPS_SMMU_CB14_TLBIIPAS2L_HIGH_APPS_ADDR A:0x1e1e63c
y.create.l HWIO_APPS_SMMU_CB15_TLBIIPAS2L_HIGH_APPS_ADDR A:0x1e1f63c
y.create.l HWIO_APPS_SMMU_CB0_TLBSYNC_APPS_ADDR A:0x1e107f0
y.create.l HWIO_APPS_SMMU_CB1_TLBSYNC_APPS_ADDR A:0x1e117f0
y.create.l HWIO_APPS_SMMU_CB2_TLBSYNC_APPS_ADDR A:0x1e127f0
y.create.l HWIO_APPS_SMMU_CB3_TLBSYNC_APPS_ADDR A:0x1e137f0
y.create.l HWIO_APPS_SMMU_CB4_TLBSYNC_APPS_ADDR A:0x1e147f0
y.create.l HWIO_APPS_SMMU_CB5_TLBSYNC_APPS_ADDR A:0x1e157f0
y.create.l HWIO_APPS_SMMU_CB6_TLBSYNC_APPS_ADDR A:0x1e167f0
y.create.l HWIO_APPS_SMMU_CB7_TLBSYNC_APPS_ADDR A:0x1e177f0
y.create.l HWIO_APPS_SMMU_CB8_TLBSYNC_APPS_ADDR A:0x1e187f0
y.create.l HWIO_APPS_SMMU_CB9_TLBSYNC_APPS_ADDR A:0x1e197f0
y.create.l HWIO_APPS_SMMU_CB10_TLBSYNC_APPS_ADDR A:0x1e1a7f0
y.create.l HWIO_APPS_SMMU_CB11_TLBSYNC_APPS_ADDR A:0x1e1b7f0
y.create.l HWIO_APPS_SMMU_CB12_TLBSYNC_APPS_ADDR A:0x1e1c7f0
y.create.l HWIO_APPS_SMMU_CB13_TLBSYNC_APPS_ADDR A:0x1e1d7f0
y.create.l HWIO_APPS_SMMU_CB14_TLBSYNC_APPS_ADDR A:0x1e1e7f0
y.create.l HWIO_APPS_SMMU_CB15_TLBSYNC_APPS_ADDR A:0x1e1f7f0
y.create.l HWIO_APPS_SMMU_CB0_TLBSTATUS_APPS_ADDR A:0x1e107f4
y.create.l HWIO_APPS_SMMU_CB1_TLBSTATUS_APPS_ADDR A:0x1e117f4
y.create.l HWIO_APPS_SMMU_CB2_TLBSTATUS_APPS_ADDR A:0x1e127f4
y.create.l HWIO_APPS_SMMU_CB3_TLBSTATUS_APPS_ADDR A:0x1e137f4
y.create.l HWIO_APPS_SMMU_CB4_TLBSTATUS_APPS_ADDR A:0x1e147f4
y.create.l HWIO_APPS_SMMU_CB5_TLBSTATUS_APPS_ADDR A:0x1e157f4
y.create.l HWIO_APPS_SMMU_CB6_TLBSTATUS_APPS_ADDR A:0x1e167f4
y.create.l HWIO_APPS_SMMU_CB7_TLBSTATUS_APPS_ADDR A:0x1e177f4
y.create.l HWIO_APPS_SMMU_CB8_TLBSTATUS_APPS_ADDR A:0x1e187f4
y.create.l HWIO_APPS_SMMU_CB9_TLBSTATUS_APPS_ADDR A:0x1e197f4
y.create.l HWIO_APPS_SMMU_CB10_TLBSTATUS_APPS_ADDR A:0x1e1a7f4
y.create.l HWIO_APPS_SMMU_CB11_TLBSTATUS_APPS_ADDR A:0x1e1b7f4
y.create.l HWIO_APPS_SMMU_CB12_TLBSTATUS_APPS_ADDR A:0x1e1c7f4
y.create.l HWIO_APPS_SMMU_CB13_TLBSTATUS_APPS_ADDR A:0x1e1d7f4
y.create.l HWIO_APPS_SMMU_CB14_TLBSTATUS_APPS_ADDR A:0x1e1e7f4
y.create.l HWIO_APPS_SMMU_CB15_TLBSTATUS_APPS_ADDR A:0x1e1f7f4
y.create.l HWIO_APPS_SMMU_CB0_PMEVCNTR0_APPS_ADDR A:0x1e10e00
y.create.l HWIO_APPS_SMMU_CB1_PMEVCNTR0_APPS_ADDR A:0x1e11e00
y.create.l HWIO_APPS_SMMU_CB2_PMEVCNTR0_APPS_ADDR A:0x1e12e00
y.create.l HWIO_APPS_SMMU_CB3_PMEVCNTR0_APPS_ADDR A:0x1e13e00
y.create.l HWIO_APPS_SMMU_CB4_PMEVCNTR0_APPS_ADDR A:0x1e14e00
y.create.l HWIO_APPS_SMMU_CB5_PMEVCNTR0_APPS_ADDR A:0x1e15e00
y.create.l HWIO_APPS_SMMU_CB6_PMEVCNTR0_APPS_ADDR A:0x1e16e00
y.create.l HWIO_APPS_SMMU_CB7_PMEVCNTR0_APPS_ADDR A:0x1e17e00
y.create.l HWIO_APPS_SMMU_CB8_PMEVCNTR0_APPS_ADDR A:0x1e18e00
y.create.l HWIO_APPS_SMMU_CB9_PMEVCNTR0_APPS_ADDR A:0x1e19e00
y.create.l HWIO_APPS_SMMU_CB10_PMEVCNTR0_APPS_ADDR A:0x1e1ae00
y.create.l HWIO_APPS_SMMU_CB11_PMEVCNTR0_APPS_ADDR A:0x1e1be00
y.create.l HWIO_APPS_SMMU_CB12_PMEVCNTR0_APPS_ADDR A:0x1e1ce00
y.create.l HWIO_APPS_SMMU_CB13_PMEVCNTR0_APPS_ADDR A:0x1e1de00
y.create.l HWIO_APPS_SMMU_CB14_PMEVCNTR0_APPS_ADDR A:0x1e1ee00
y.create.l HWIO_APPS_SMMU_CB15_PMEVCNTR0_APPS_ADDR A:0x1e1fe00
y.create.l HWIO_APPS_SMMU_CB0_PMEVCNTR1_APPS_ADDR A:0x1e10e04
y.create.l HWIO_APPS_SMMU_CB1_PMEVCNTR1_APPS_ADDR A:0x1e11e04
y.create.l HWIO_APPS_SMMU_CB2_PMEVCNTR1_APPS_ADDR A:0x1e12e04
y.create.l HWIO_APPS_SMMU_CB3_PMEVCNTR1_APPS_ADDR A:0x1e13e04
y.create.l HWIO_APPS_SMMU_CB4_PMEVCNTR1_APPS_ADDR A:0x1e14e04
y.create.l HWIO_APPS_SMMU_CB5_PMEVCNTR1_APPS_ADDR A:0x1e15e04
y.create.l HWIO_APPS_SMMU_CB6_PMEVCNTR1_APPS_ADDR A:0x1e16e04
y.create.l HWIO_APPS_SMMU_CB7_PMEVCNTR1_APPS_ADDR A:0x1e17e04
y.create.l HWIO_APPS_SMMU_CB8_PMEVCNTR1_APPS_ADDR A:0x1e18e04
y.create.l HWIO_APPS_SMMU_CB9_PMEVCNTR1_APPS_ADDR A:0x1e19e04
y.create.l HWIO_APPS_SMMU_CB10_PMEVCNTR1_APPS_ADDR A:0x1e1ae04
y.create.l HWIO_APPS_SMMU_CB11_PMEVCNTR1_APPS_ADDR A:0x1e1be04
y.create.l HWIO_APPS_SMMU_CB12_PMEVCNTR1_APPS_ADDR A:0x1e1ce04
y.create.l HWIO_APPS_SMMU_CB13_PMEVCNTR1_APPS_ADDR A:0x1e1de04
y.create.l HWIO_APPS_SMMU_CB14_PMEVCNTR1_APPS_ADDR A:0x1e1ee04
y.create.l HWIO_APPS_SMMU_CB15_PMEVCNTR1_APPS_ADDR A:0x1e1fe04
y.create.l HWIO_APPS_SMMU_CB0_PMEVCNTR2_APPS_ADDR A:0x1e10e08
y.create.l HWIO_APPS_SMMU_CB1_PMEVCNTR2_APPS_ADDR A:0x1e11e08
y.create.l HWIO_APPS_SMMU_CB2_PMEVCNTR2_APPS_ADDR A:0x1e12e08
y.create.l HWIO_APPS_SMMU_CB3_PMEVCNTR2_APPS_ADDR A:0x1e13e08
y.create.l HWIO_APPS_SMMU_CB4_PMEVCNTR2_APPS_ADDR A:0x1e14e08
y.create.l HWIO_APPS_SMMU_CB5_PMEVCNTR2_APPS_ADDR A:0x1e15e08
y.create.l HWIO_APPS_SMMU_CB6_PMEVCNTR2_APPS_ADDR A:0x1e16e08
y.create.l HWIO_APPS_SMMU_CB7_PMEVCNTR2_APPS_ADDR A:0x1e17e08
y.create.l HWIO_APPS_SMMU_CB8_PMEVCNTR2_APPS_ADDR A:0x1e18e08
y.create.l HWIO_APPS_SMMU_CB9_PMEVCNTR2_APPS_ADDR A:0x1e19e08
y.create.l HWIO_APPS_SMMU_CB10_PMEVCNTR2_APPS_ADDR A:0x1e1ae08
y.create.l HWIO_APPS_SMMU_CB11_PMEVCNTR2_APPS_ADDR A:0x1e1be08
y.create.l HWIO_APPS_SMMU_CB12_PMEVCNTR2_APPS_ADDR A:0x1e1ce08
y.create.l HWIO_APPS_SMMU_CB13_PMEVCNTR2_APPS_ADDR A:0x1e1de08
y.create.l HWIO_APPS_SMMU_CB14_PMEVCNTR2_APPS_ADDR A:0x1e1ee08
y.create.l HWIO_APPS_SMMU_CB15_PMEVCNTR2_APPS_ADDR A:0x1e1fe08
y.create.l HWIO_APPS_SMMU_CB0_PMEVCNTR3_APPS_ADDR A:0x1e10e0c
y.create.l HWIO_APPS_SMMU_CB1_PMEVCNTR3_APPS_ADDR A:0x1e11e0c
y.create.l HWIO_APPS_SMMU_CB2_PMEVCNTR3_APPS_ADDR A:0x1e12e0c
y.create.l HWIO_APPS_SMMU_CB3_PMEVCNTR3_APPS_ADDR A:0x1e13e0c
y.create.l HWIO_APPS_SMMU_CB4_PMEVCNTR3_APPS_ADDR A:0x1e14e0c
y.create.l HWIO_APPS_SMMU_CB5_PMEVCNTR3_APPS_ADDR A:0x1e15e0c
y.create.l HWIO_APPS_SMMU_CB6_PMEVCNTR3_APPS_ADDR A:0x1e16e0c
y.create.l HWIO_APPS_SMMU_CB7_PMEVCNTR3_APPS_ADDR A:0x1e17e0c
y.create.l HWIO_APPS_SMMU_CB8_PMEVCNTR3_APPS_ADDR A:0x1e18e0c
y.create.l HWIO_APPS_SMMU_CB9_PMEVCNTR3_APPS_ADDR A:0x1e19e0c
y.create.l HWIO_APPS_SMMU_CB10_PMEVCNTR3_APPS_ADDR A:0x1e1ae0c
y.create.l HWIO_APPS_SMMU_CB11_PMEVCNTR3_APPS_ADDR A:0x1e1be0c
y.create.l HWIO_APPS_SMMU_CB12_PMEVCNTR3_APPS_ADDR A:0x1e1ce0c
y.create.l HWIO_APPS_SMMU_CB13_PMEVCNTR3_APPS_ADDR A:0x1e1de0c
y.create.l HWIO_APPS_SMMU_CB14_PMEVCNTR3_APPS_ADDR A:0x1e1ee0c
y.create.l HWIO_APPS_SMMU_CB15_PMEVCNTR3_APPS_ADDR A:0x1e1fe0c
y.create.l HWIO_APPS_SMMU_CB0_PMEVTYPER0_APPS_ADDR A:0x1e10e80
y.create.l HWIO_APPS_SMMU_CB1_PMEVTYPER0_APPS_ADDR A:0x1e11e80
y.create.l HWIO_APPS_SMMU_CB2_PMEVTYPER0_APPS_ADDR A:0x1e12e80
y.create.l HWIO_APPS_SMMU_CB3_PMEVTYPER0_APPS_ADDR A:0x1e13e80
y.create.l HWIO_APPS_SMMU_CB4_PMEVTYPER0_APPS_ADDR A:0x1e14e80
y.create.l HWIO_APPS_SMMU_CB5_PMEVTYPER0_APPS_ADDR A:0x1e15e80
y.create.l HWIO_APPS_SMMU_CB6_PMEVTYPER0_APPS_ADDR A:0x1e16e80
y.create.l HWIO_APPS_SMMU_CB7_PMEVTYPER0_APPS_ADDR A:0x1e17e80
y.create.l HWIO_APPS_SMMU_CB8_PMEVTYPER0_APPS_ADDR A:0x1e18e80
y.create.l HWIO_APPS_SMMU_CB9_PMEVTYPER0_APPS_ADDR A:0x1e19e80
y.create.l HWIO_APPS_SMMU_CB10_PMEVTYPER0_APPS_ADDR A:0x1e1ae80
y.create.l HWIO_APPS_SMMU_CB11_PMEVTYPER0_APPS_ADDR A:0x1e1be80
y.create.l HWIO_APPS_SMMU_CB12_PMEVTYPER0_APPS_ADDR A:0x1e1ce80
y.create.l HWIO_APPS_SMMU_CB13_PMEVTYPER0_APPS_ADDR A:0x1e1de80
y.create.l HWIO_APPS_SMMU_CB14_PMEVTYPER0_APPS_ADDR A:0x1e1ee80
y.create.l HWIO_APPS_SMMU_CB15_PMEVTYPER0_APPS_ADDR A:0x1e1fe80
y.create.l HWIO_APPS_SMMU_CB0_PMEVTYPER1_APPS_ADDR A:0x1e10e84
y.create.l HWIO_APPS_SMMU_CB1_PMEVTYPER1_APPS_ADDR A:0x1e11e84
y.create.l HWIO_APPS_SMMU_CB2_PMEVTYPER1_APPS_ADDR A:0x1e12e84
y.create.l HWIO_APPS_SMMU_CB3_PMEVTYPER1_APPS_ADDR A:0x1e13e84
y.create.l HWIO_APPS_SMMU_CB4_PMEVTYPER1_APPS_ADDR A:0x1e14e84
y.create.l HWIO_APPS_SMMU_CB5_PMEVTYPER1_APPS_ADDR A:0x1e15e84
y.create.l HWIO_APPS_SMMU_CB6_PMEVTYPER1_APPS_ADDR A:0x1e16e84
y.create.l HWIO_APPS_SMMU_CB7_PMEVTYPER1_APPS_ADDR A:0x1e17e84
y.create.l HWIO_APPS_SMMU_CB8_PMEVTYPER1_APPS_ADDR A:0x1e18e84
y.create.l HWIO_APPS_SMMU_CB9_PMEVTYPER1_APPS_ADDR A:0x1e19e84
y.create.l HWIO_APPS_SMMU_CB10_PMEVTYPER1_APPS_ADDR A:0x1e1ae84
y.create.l HWIO_APPS_SMMU_CB11_PMEVTYPER1_APPS_ADDR A:0x1e1be84
y.create.l HWIO_APPS_SMMU_CB12_PMEVTYPER1_APPS_ADDR A:0x1e1ce84
y.create.l HWIO_APPS_SMMU_CB13_PMEVTYPER1_APPS_ADDR A:0x1e1de84
y.create.l HWIO_APPS_SMMU_CB14_PMEVTYPER1_APPS_ADDR A:0x1e1ee84
y.create.l HWIO_APPS_SMMU_CB15_PMEVTYPER1_APPS_ADDR A:0x1e1fe84
y.create.l HWIO_APPS_SMMU_CB0_PMEVTYPER2_APPS_ADDR A:0x1e10e88
y.create.l HWIO_APPS_SMMU_CB1_PMEVTYPER2_APPS_ADDR A:0x1e11e88
y.create.l HWIO_APPS_SMMU_CB2_PMEVTYPER2_APPS_ADDR A:0x1e12e88
y.create.l HWIO_APPS_SMMU_CB3_PMEVTYPER2_APPS_ADDR A:0x1e13e88
y.create.l HWIO_APPS_SMMU_CB4_PMEVTYPER2_APPS_ADDR A:0x1e14e88
y.create.l HWIO_APPS_SMMU_CB5_PMEVTYPER2_APPS_ADDR A:0x1e15e88
y.create.l HWIO_APPS_SMMU_CB6_PMEVTYPER2_APPS_ADDR A:0x1e16e88
y.create.l HWIO_APPS_SMMU_CB7_PMEVTYPER2_APPS_ADDR A:0x1e17e88
y.create.l HWIO_APPS_SMMU_CB8_PMEVTYPER2_APPS_ADDR A:0x1e18e88
y.create.l HWIO_APPS_SMMU_CB9_PMEVTYPER2_APPS_ADDR A:0x1e19e88
y.create.l HWIO_APPS_SMMU_CB10_PMEVTYPER2_APPS_ADDR A:0x1e1ae88
y.create.l HWIO_APPS_SMMU_CB11_PMEVTYPER2_APPS_ADDR A:0x1e1be88
y.create.l HWIO_APPS_SMMU_CB12_PMEVTYPER2_APPS_ADDR A:0x1e1ce88
y.create.l HWIO_APPS_SMMU_CB13_PMEVTYPER2_APPS_ADDR A:0x1e1de88
y.create.l HWIO_APPS_SMMU_CB14_PMEVTYPER2_APPS_ADDR A:0x1e1ee88
y.create.l HWIO_APPS_SMMU_CB15_PMEVTYPER2_APPS_ADDR A:0x1e1fe88
y.create.l HWIO_APPS_SMMU_CB0_PMEVTYPER3_APPS_ADDR A:0x1e10e8c
y.create.l HWIO_APPS_SMMU_CB1_PMEVTYPER3_APPS_ADDR A:0x1e11e8c
y.create.l HWIO_APPS_SMMU_CB2_PMEVTYPER3_APPS_ADDR A:0x1e12e8c
y.create.l HWIO_APPS_SMMU_CB3_PMEVTYPER3_APPS_ADDR A:0x1e13e8c
y.create.l HWIO_APPS_SMMU_CB4_PMEVTYPER3_APPS_ADDR A:0x1e14e8c
y.create.l HWIO_APPS_SMMU_CB5_PMEVTYPER3_APPS_ADDR A:0x1e15e8c
y.create.l HWIO_APPS_SMMU_CB6_PMEVTYPER3_APPS_ADDR A:0x1e16e8c
y.create.l HWIO_APPS_SMMU_CB7_PMEVTYPER3_APPS_ADDR A:0x1e17e8c
y.create.l HWIO_APPS_SMMU_CB8_PMEVTYPER3_APPS_ADDR A:0x1e18e8c
y.create.l HWIO_APPS_SMMU_CB9_PMEVTYPER3_APPS_ADDR A:0x1e19e8c
y.create.l HWIO_APPS_SMMU_CB10_PMEVTYPER3_APPS_ADDR A:0x1e1ae8c
y.create.l HWIO_APPS_SMMU_CB11_PMEVTYPER3_APPS_ADDR A:0x1e1be8c
y.create.l HWIO_APPS_SMMU_CB12_PMEVTYPER3_APPS_ADDR A:0x1e1ce8c
y.create.l HWIO_APPS_SMMU_CB13_PMEVTYPER3_APPS_ADDR A:0x1e1de8c
y.create.l HWIO_APPS_SMMU_CB14_PMEVTYPER3_APPS_ADDR A:0x1e1ee8c
y.create.l HWIO_APPS_SMMU_CB15_PMEVTYPER3_APPS_ADDR A:0x1e1fe8c
y.create.l HWIO_APPS_SMMU_CB0_PMCFGR_APPS_ADDR A:0x1e10f00
y.create.l HWIO_APPS_SMMU_CB1_PMCFGR_APPS_ADDR A:0x1e11f00
y.create.l HWIO_APPS_SMMU_CB2_PMCFGR_APPS_ADDR A:0x1e12f00
y.create.l HWIO_APPS_SMMU_CB3_PMCFGR_APPS_ADDR A:0x1e13f00
y.create.l HWIO_APPS_SMMU_CB4_PMCFGR_APPS_ADDR A:0x1e14f00
y.create.l HWIO_APPS_SMMU_CB5_PMCFGR_APPS_ADDR A:0x1e15f00
y.create.l HWIO_APPS_SMMU_CB6_PMCFGR_APPS_ADDR A:0x1e16f00
y.create.l HWIO_APPS_SMMU_CB7_PMCFGR_APPS_ADDR A:0x1e17f00
y.create.l HWIO_APPS_SMMU_CB8_PMCFGR_APPS_ADDR A:0x1e18f00
y.create.l HWIO_APPS_SMMU_CB9_PMCFGR_APPS_ADDR A:0x1e19f00
y.create.l HWIO_APPS_SMMU_CB10_PMCFGR_APPS_ADDR A:0x1e1af00
y.create.l HWIO_APPS_SMMU_CB11_PMCFGR_APPS_ADDR A:0x1e1bf00
y.create.l HWIO_APPS_SMMU_CB12_PMCFGR_APPS_ADDR A:0x1e1cf00
y.create.l HWIO_APPS_SMMU_CB13_PMCFGR_APPS_ADDR A:0x1e1df00
y.create.l HWIO_APPS_SMMU_CB14_PMCFGR_APPS_ADDR A:0x1e1ef00
y.create.l HWIO_APPS_SMMU_CB15_PMCFGR_APPS_ADDR A:0x1e1ff00
y.create.l HWIO_APPS_SMMU_CB0_PMCR_APPS_ADDR A:0x1e10f04
y.create.l HWIO_APPS_SMMU_CB1_PMCR_APPS_ADDR A:0x1e11f04
y.create.l HWIO_APPS_SMMU_CB2_PMCR_APPS_ADDR A:0x1e12f04
y.create.l HWIO_APPS_SMMU_CB3_PMCR_APPS_ADDR A:0x1e13f04
y.create.l HWIO_APPS_SMMU_CB4_PMCR_APPS_ADDR A:0x1e14f04
y.create.l HWIO_APPS_SMMU_CB5_PMCR_APPS_ADDR A:0x1e15f04
y.create.l HWIO_APPS_SMMU_CB6_PMCR_APPS_ADDR A:0x1e16f04
y.create.l HWIO_APPS_SMMU_CB7_PMCR_APPS_ADDR A:0x1e17f04
y.create.l HWIO_APPS_SMMU_CB8_PMCR_APPS_ADDR A:0x1e18f04
y.create.l HWIO_APPS_SMMU_CB9_PMCR_APPS_ADDR A:0x1e19f04
y.create.l HWIO_APPS_SMMU_CB10_PMCR_APPS_ADDR A:0x1e1af04
y.create.l HWIO_APPS_SMMU_CB11_PMCR_APPS_ADDR A:0x1e1bf04
y.create.l HWIO_APPS_SMMU_CB12_PMCR_APPS_ADDR A:0x1e1cf04
y.create.l HWIO_APPS_SMMU_CB13_PMCR_APPS_ADDR A:0x1e1df04
y.create.l HWIO_APPS_SMMU_CB14_PMCR_APPS_ADDR A:0x1e1ef04
y.create.l HWIO_APPS_SMMU_CB15_PMCR_APPS_ADDR A:0x1e1ff04
y.create.l HWIO_APPS_SMMU_CB0_PMCEID_APPS_ADDR A:0x1e10f20
y.create.l HWIO_APPS_SMMU_CB1_PMCEID_APPS_ADDR A:0x1e11f20
y.create.l HWIO_APPS_SMMU_CB2_PMCEID_APPS_ADDR A:0x1e12f20
y.create.l HWIO_APPS_SMMU_CB3_PMCEID_APPS_ADDR A:0x1e13f20
y.create.l HWIO_APPS_SMMU_CB4_PMCEID_APPS_ADDR A:0x1e14f20
y.create.l HWIO_APPS_SMMU_CB5_PMCEID_APPS_ADDR A:0x1e15f20
y.create.l HWIO_APPS_SMMU_CB6_PMCEID_APPS_ADDR A:0x1e16f20
y.create.l HWIO_APPS_SMMU_CB7_PMCEID_APPS_ADDR A:0x1e17f20
y.create.l HWIO_APPS_SMMU_CB8_PMCEID_APPS_ADDR A:0x1e18f20
y.create.l HWIO_APPS_SMMU_CB9_PMCEID_APPS_ADDR A:0x1e19f20
y.create.l HWIO_APPS_SMMU_CB10_PMCEID_APPS_ADDR A:0x1e1af20
y.create.l HWIO_APPS_SMMU_CB11_PMCEID_APPS_ADDR A:0x1e1bf20
y.create.l HWIO_APPS_SMMU_CB12_PMCEID_APPS_ADDR A:0x1e1cf20
y.create.l HWIO_APPS_SMMU_CB13_PMCEID_APPS_ADDR A:0x1e1df20
y.create.l HWIO_APPS_SMMU_CB14_PMCEID_APPS_ADDR A:0x1e1ef20
y.create.l HWIO_APPS_SMMU_CB15_PMCEID_APPS_ADDR A:0x1e1ff20
y.create.l HWIO_APPS_SMMU_CB0_PMCNTENSE_APPS_ADDR A:0x1e10f40
y.create.l HWIO_APPS_SMMU_CB1_PMCNTENSE_APPS_ADDR A:0x1e11f40
y.create.l HWIO_APPS_SMMU_CB2_PMCNTENSE_APPS_ADDR A:0x1e12f40
y.create.l HWIO_APPS_SMMU_CB3_PMCNTENSE_APPS_ADDR A:0x1e13f40
y.create.l HWIO_APPS_SMMU_CB4_PMCNTENSE_APPS_ADDR A:0x1e14f40
y.create.l HWIO_APPS_SMMU_CB5_PMCNTENSE_APPS_ADDR A:0x1e15f40
y.create.l HWIO_APPS_SMMU_CB6_PMCNTENSE_APPS_ADDR A:0x1e16f40
y.create.l HWIO_APPS_SMMU_CB7_PMCNTENSE_APPS_ADDR A:0x1e17f40
y.create.l HWIO_APPS_SMMU_CB8_PMCNTENSE_APPS_ADDR A:0x1e18f40
y.create.l HWIO_APPS_SMMU_CB9_PMCNTENSE_APPS_ADDR A:0x1e19f40
y.create.l HWIO_APPS_SMMU_CB10_PMCNTENSE_APPS_ADDR A:0x1e1af40
y.create.l HWIO_APPS_SMMU_CB11_PMCNTENSE_APPS_ADDR A:0x1e1bf40
y.create.l HWIO_APPS_SMMU_CB12_PMCNTENSE_APPS_ADDR A:0x1e1cf40
y.create.l HWIO_APPS_SMMU_CB13_PMCNTENSE_APPS_ADDR A:0x1e1df40
y.create.l HWIO_APPS_SMMU_CB14_PMCNTENSE_APPS_ADDR A:0x1e1ef40
y.create.l HWIO_APPS_SMMU_CB15_PMCNTENSE_APPS_ADDR A:0x1e1ff40
y.create.l HWIO_APPS_SMMU_CB0_PMCNTENCLR_APPS_ADDR A:0x1e10f44
y.create.l HWIO_APPS_SMMU_CB1_PMCNTENCLR_APPS_ADDR A:0x1e11f44
y.create.l HWIO_APPS_SMMU_CB2_PMCNTENCLR_APPS_ADDR A:0x1e12f44
y.create.l HWIO_APPS_SMMU_CB3_PMCNTENCLR_APPS_ADDR A:0x1e13f44
y.create.l HWIO_APPS_SMMU_CB4_PMCNTENCLR_APPS_ADDR A:0x1e14f44
y.create.l HWIO_APPS_SMMU_CB5_PMCNTENCLR_APPS_ADDR A:0x1e15f44
y.create.l HWIO_APPS_SMMU_CB6_PMCNTENCLR_APPS_ADDR A:0x1e16f44
y.create.l HWIO_APPS_SMMU_CB7_PMCNTENCLR_APPS_ADDR A:0x1e17f44
y.create.l HWIO_APPS_SMMU_CB8_PMCNTENCLR_APPS_ADDR A:0x1e18f44
y.create.l HWIO_APPS_SMMU_CB9_PMCNTENCLR_APPS_ADDR A:0x1e19f44
y.create.l HWIO_APPS_SMMU_CB10_PMCNTENCLR_APPS_ADDR A:0x1e1af44
y.create.l HWIO_APPS_SMMU_CB11_PMCNTENCLR_APPS_ADDR A:0x1e1bf44
y.create.l HWIO_APPS_SMMU_CB12_PMCNTENCLR_APPS_ADDR A:0x1e1cf44
y.create.l HWIO_APPS_SMMU_CB13_PMCNTENCLR_APPS_ADDR A:0x1e1df44
y.create.l HWIO_APPS_SMMU_CB14_PMCNTENCLR_APPS_ADDR A:0x1e1ef44
y.create.l HWIO_APPS_SMMU_CB15_PMCNTENCLR_APPS_ADDR A:0x1e1ff44
y.create.l HWIO_APPS_SMMU_CB0_PMCNTENSET_APPS_ADDR A:0x1e10f48
y.create.l HWIO_APPS_SMMU_CB1_PMCNTENSET_APPS_ADDR A:0x1e11f48
y.create.l HWIO_APPS_SMMU_CB2_PMCNTENSET_APPS_ADDR A:0x1e12f48
y.create.l HWIO_APPS_SMMU_CB3_PMCNTENSET_APPS_ADDR A:0x1e13f48
y.create.l HWIO_APPS_SMMU_CB4_PMCNTENSET_APPS_ADDR A:0x1e14f48
y.create.l HWIO_APPS_SMMU_CB5_PMCNTENSET_APPS_ADDR A:0x1e15f48
y.create.l HWIO_APPS_SMMU_CB6_PMCNTENSET_APPS_ADDR A:0x1e16f48
y.create.l HWIO_APPS_SMMU_CB7_PMCNTENSET_APPS_ADDR A:0x1e17f48
y.create.l HWIO_APPS_SMMU_CB8_PMCNTENSET_APPS_ADDR A:0x1e18f48
y.create.l HWIO_APPS_SMMU_CB9_PMCNTENSET_APPS_ADDR A:0x1e19f48
y.create.l HWIO_APPS_SMMU_CB10_PMCNTENSET_APPS_ADDR A:0x1e1af48
y.create.l HWIO_APPS_SMMU_CB11_PMCNTENSET_APPS_ADDR A:0x1e1bf48
y.create.l HWIO_APPS_SMMU_CB12_PMCNTENSET_APPS_ADDR A:0x1e1cf48
y.create.l HWIO_APPS_SMMU_CB13_PMCNTENSET_APPS_ADDR A:0x1e1df48
y.create.l HWIO_APPS_SMMU_CB14_PMCNTENSET_APPS_ADDR A:0x1e1ef48
y.create.l HWIO_APPS_SMMU_CB15_PMCNTENSET_APPS_ADDR A:0x1e1ff48
y.create.l HWIO_APPS_SMMU_CB0_PMINTENCLR_APPS_ADDR A:0x1e10f4c
y.create.l HWIO_APPS_SMMU_CB1_PMINTENCLR_APPS_ADDR A:0x1e11f4c
y.create.l HWIO_APPS_SMMU_CB2_PMINTENCLR_APPS_ADDR A:0x1e12f4c
y.create.l HWIO_APPS_SMMU_CB3_PMINTENCLR_APPS_ADDR A:0x1e13f4c
y.create.l HWIO_APPS_SMMU_CB4_PMINTENCLR_APPS_ADDR A:0x1e14f4c
y.create.l HWIO_APPS_SMMU_CB5_PMINTENCLR_APPS_ADDR A:0x1e15f4c
y.create.l HWIO_APPS_SMMU_CB6_PMINTENCLR_APPS_ADDR A:0x1e16f4c
y.create.l HWIO_APPS_SMMU_CB7_PMINTENCLR_APPS_ADDR A:0x1e17f4c
y.create.l HWIO_APPS_SMMU_CB8_PMINTENCLR_APPS_ADDR A:0x1e18f4c
y.create.l HWIO_APPS_SMMU_CB9_PMINTENCLR_APPS_ADDR A:0x1e19f4c
y.create.l HWIO_APPS_SMMU_CB10_PMINTENCLR_APPS_ADDR A:0x1e1af4c
y.create.l HWIO_APPS_SMMU_CB11_PMINTENCLR_APPS_ADDR A:0x1e1bf4c
y.create.l HWIO_APPS_SMMU_CB12_PMINTENCLR_APPS_ADDR A:0x1e1cf4c
y.create.l HWIO_APPS_SMMU_CB13_PMINTENCLR_APPS_ADDR A:0x1e1df4c
y.create.l HWIO_APPS_SMMU_CB14_PMINTENCLR_APPS_ADDR A:0x1e1ef4c
y.create.l HWIO_APPS_SMMU_CB15_PMINTENCLR_APPS_ADDR A:0x1e1ff4c
y.create.l HWIO_APPS_SMMU_CB0_PMOVSCLR_APPS_ADDR A:0x1e10f50
y.create.l HWIO_APPS_SMMU_CB1_PMOVSCLR_APPS_ADDR A:0x1e11f50
y.create.l HWIO_APPS_SMMU_CB2_PMOVSCLR_APPS_ADDR A:0x1e12f50
y.create.l HWIO_APPS_SMMU_CB3_PMOVSCLR_APPS_ADDR A:0x1e13f50
y.create.l HWIO_APPS_SMMU_CB4_PMOVSCLR_APPS_ADDR A:0x1e14f50
y.create.l HWIO_APPS_SMMU_CB5_PMOVSCLR_APPS_ADDR A:0x1e15f50
y.create.l HWIO_APPS_SMMU_CB6_PMOVSCLR_APPS_ADDR A:0x1e16f50
y.create.l HWIO_APPS_SMMU_CB7_PMOVSCLR_APPS_ADDR A:0x1e17f50
y.create.l HWIO_APPS_SMMU_CB8_PMOVSCLR_APPS_ADDR A:0x1e18f50
y.create.l HWIO_APPS_SMMU_CB9_PMOVSCLR_APPS_ADDR A:0x1e19f50
y.create.l HWIO_APPS_SMMU_CB10_PMOVSCLR_APPS_ADDR A:0x1e1af50
y.create.l HWIO_APPS_SMMU_CB11_PMOVSCLR_APPS_ADDR A:0x1e1bf50
y.create.l HWIO_APPS_SMMU_CB12_PMOVSCLR_APPS_ADDR A:0x1e1cf50
y.create.l HWIO_APPS_SMMU_CB13_PMOVSCLR_APPS_ADDR A:0x1e1df50
y.create.l HWIO_APPS_SMMU_CB14_PMOVSCLR_APPS_ADDR A:0x1e1ef50
y.create.l HWIO_APPS_SMMU_CB15_PMOVSCLR_APPS_ADDR A:0x1e1ff50
y.create.l HWIO_APPS_SMMU_CB0_PMOVSSET_APPS_ADDR A:0x1e10f58
y.create.l HWIO_APPS_SMMU_CB1_PMOVSSET_APPS_ADDR A:0x1e11f58
y.create.l HWIO_APPS_SMMU_CB2_PMOVSSET_APPS_ADDR A:0x1e12f58
y.create.l HWIO_APPS_SMMU_CB3_PMOVSSET_APPS_ADDR A:0x1e13f58
y.create.l HWIO_APPS_SMMU_CB4_PMOVSSET_APPS_ADDR A:0x1e14f58
y.create.l HWIO_APPS_SMMU_CB5_PMOVSSET_APPS_ADDR A:0x1e15f58
y.create.l HWIO_APPS_SMMU_CB6_PMOVSSET_APPS_ADDR A:0x1e16f58
y.create.l HWIO_APPS_SMMU_CB7_PMOVSSET_APPS_ADDR A:0x1e17f58
y.create.l HWIO_APPS_SMMU_CB8_PMOVSSET_APPS_ADDR A:0x1e18f58
y.create.l HWIO_APPS_SMMU_CB9_PMOVSSET_APPS_ADDR A:0x1e19f58
y.create.l HWIO_APPS_SMMU_CB10_PMOVSSET_APPS_ADDR A:0x1e1af58
y.create.l HWIO_APPS_SMMU_CB11_PMOVSSET_APPS_ADDR A:0x1e1bf58
y.create.l HWIO_APPS_SMMU_CB12_PMOVSSET_APPS_ADDR A:0x1e1cf58
y.create.l HWIO_APPS_SMMU_CB13_PMOVSSET_APPS_ADDR A:0x1e1df58
y.create.l HWIO_APPS_SMMU_CB14_PMOVSSET_APPS_ADDR A:0x1e1ef58
y.create.l HWIO_APPS_SMMU_CB15_PMOVSSET_APPS_ADDR A:0x1e1ff58
y.create.l HWIO_APPS_SMMU_CB0_PMAUTHSTATUS_APPS_ADDR A:0x1e10fb8
y.create.l HWIO_APPS_SMMU_CB1_PMAUTHSTATUS_APPS_ADDR A:0x1e11fb8
y.create.l HWIO_APPS_SMMU_CB2_PMAUTHSTATUS_APPS_ADDR A:0x1e12fb8
y.create.l HWIO_APPS_SMMU_CB3_PMAUTHSTATUS_APPS_ADDR A:0x1e13fb8
y.create.l HWIO_APPS_SMMU_CB4_PMAUTHSTATUS_APPS_ADDR A:0x1e14fb8
y.create.l HWIO_APPS_SMMU_CB5_PMAUTHSTATUS_APPS_ADDR A:0x1e15fb8
y.create.l HWIO_APPS_SMMU_CB6_PMAUTHSTATUS_APPS_ADDR A:0x1e16fb8
y.create.l HWIO_APPS_SMMU_CB7_PMAUTHSTATUS_APPS_ADDR A:0x1e17fb8
y.create.l HWIO_APPS_SMMU_CB8_PMAUTHSTATUS_APPS_ADDR A:0x1e18fb8
y.create.l HWIO_APPS_SMMU_CB9_PMAUTHSTATUS_APPS_ADDR A:0x1e19fb8
y.create.l HWIO_APPS_SMMU_CB10_PMAUTHSTATUS_APPS_ADDR A:0x1e1afb8
y.create.l HWIO_APPS_SMMU_CB11_PMAUTHSTATUS_APPS_ADDR A:0x1e1bfb8
y.create.l HWIO_APPS_SMMU_CB12_PMAUTHSTATUS_APPS_ADDR A:0x1e1cfb8
y.create.l HWIO_APPS_SMMU_CB13_PMAUTHSTATUS_APPS_ADDR A:0x1e1dfb8
y.create.l HWIO_APPS_SMMU_CB14_PMAUTHSTATUS_APPS_ADDR A:0x1e1efb8
y.create.l HWIO_APPS_SMMU_CB15_PMAUTHSTATUS_APPS_ADDR A:0x1e1ffb8
y.create.l HWIO_APPS_SMMU_CR0_APPS_ADDR A:0x1e00000
y.create.l HWIO_APPS_SMMU_ACR_APPS_ADDR A:0x1e00010
y.create.l HWIO_APPS_SMMU_IDR0_APPS_ADDR A:0x1e00020
y.create.l HWIO_APPS_SMMU_IDR1_APPS_ADDR A:0x1e00024
y.create.l HWIO_APPS_SMMU_IDR2_APPS_ADDR A:0x1e00028
y.create.l HWIO_APPS_SMMU_IDR7_APPS_ADDR A:0x1e0003c
y.create.l HWIO_APPS_SMMU_GFAR_LOW_APPS_ADDR A:0x1e00040
y.create.l HWIO_APPS_SMMU_GFAR_HIGH_APPS_ADDR A:0x1e00044
y.create.l HWIO_APPS_SMMU_GFSR_APPS_ADDR A:0x1e00048
y.create.l HWIO_APPS_SMMU_GFSRRESTORE_APPS_ADDR A:0x1e0004c
y.create.l HWIO_APPS_SMMU_GFSYNR0_APPS_ADDR A:0x1e00050
y.create.l HWIO_APPS_SMMU_GFSYNR1_APPS_ADDR A:0x1e00054
y.create.l HWIO_APPS_SMMU_TLBIVMID_2_APPS_ADDR A:0x1e00064
y.create.l HWIO_APPS_SMMU_TLBIALLNSNH_2_APPS_ADDR A:0x1e00068
y.create.l HWIO_APPS_SMMU_TLBIALLH_APPS_ADDR A:0x1e0006c
y.create.l HWIO_APPS_SMMU_TLBGSYNC_APPS_ADDR A:0x1e00070
y.create.l HWIO_APPS_SMMU_TLBGSTATUS_APPS_ADDR A:0x1e00074
y.create.l HWIO_APPS_SMMU_TLBIVAH_LOW_APPS_ADDR A:0x1e00078
y.create.l HWIO_APPS_SMMU_TLBIVALH64_LOW_APPS_ADDR A:0x1e000b0
y.create.l HWIO_APPS_SMMU_TLBIVALH64_HIGH_APPS_ADDR A:0x1e000b4
y.create.l HWIO_APPS_SMMU_TLBIVMIDS1_APPS_ADDR A:0x1e000b8
y.create.l HWIO_APPS_SMMU_TLBIVAH64_LOW_APPS_ADDR A:0x1e000c0
y.create.l HWIO_APPS_SMMU_TLBIVAH64_HIGH_APPS_ADDR A:0x1e000c4
y.create.l HWIO_APPS_SMMU_SMR0_2_APPS_ADDR A:0x1e00800
y.create.l HWIO_APPS_SMMU_SMR1_2_APPS_ADDR A:0x1e00804
y.create.l HWIO_APPS_SMMU_SMR2_2_APPS_ADDR A:0x1e00808
y.create.l HWIO_APPS_SMMU_SMR3_2_APPS_ADDR A:0x1e0080c
y.create.l HWIO_APPS_SMMU_SMR4_2_APPS_ADDR A:0x1e00810
y.create.l HWIO_APPS_SMMU_SMR5_2_APPS_ADDR A:0x1e00814
y.create.l HWIO_APPS_SMMU_SMR6_2_APPS_ADDR A:0x1e00818
y.create.l HWIO_APPS_SMMU_SMR7_2_APPS_ADDR A:0x1e0081c
y.create.l HWIO_APPS_SMMU_SMR8_2_APPS_ADDR A:0x1e00820
y.create.l HWIO_APPS_SMMU_SMR9_2_APPS_ADDR A:0x1e00824
y.create.l HWIO_APPS_SMMU_SMR10_2_APPS_ADDR A:0x1e00828
y.create.l HWIO_APPS_SMMU_SMR11_2_APPS_ADDR A:0x1e0082c
y.create.l HWIO_APPS_SMMU_SMR12_2_APPS_ADDR A:0x1e00830
y.create.l HWIO_APPS_SMMU_SMR13_2_APPS_ADDR A:0x1e00834
y.create.l HWIO_APPS_SMMU_SMR14_2_APPS_ADDR A:0x1e00838
y.create.l HWIO_APPS_SMMU_SMR15_2_APPS_ADDR A:0x1e0083c
y.create.l HWIO_APPS_SMMU_SMR16_2_APPS_ADDR A:0x1e00840
y.create.l HWIO_APPS_SMMU_SMR17_2_APPS_ADDR A:0x1e00844
y.create.l HWIO_APPS_SMMU_SMR18_2_APPS_ADDR A:0x1e00848
y.create.l HWIO_APPS_SMMU_SMR19_2_APPS_ADDR A:0x1e0084c
y.create.l HWIO_APPS_SMMU_SMR20_2_APPS_ADDR A:0x1e00850
y.create.l HWIO_APPS_SMMU_SMR21_2_APPS_ADDR A:0x1e00854
y.create.l HWIO_APPS_SMMU_SMR22_2_APPS_ADDR A:0x1e00858
y.create.l HWIO_APPS_SMMU_SMR23_2_APPS_ADDR A:0x1e0085c
y.create.l HWIO_APPS_SMMU_SMR24_2_APPS_ADDR A:0x1e00860
y.create.l HWIO_APPS_SMMU_SMR25_2_APPS_ADDR A:0x1e00864
y.create.l HWIO_APPS_SMMU_SMR26_2_APPS_ADDR A:0x1e00868
y.create.l HWIO_APPS_SMMU_SMR27_2_APPS_ADDR A:0x1e0086c
y.create.l HWIO_APPS_SMMU_SMR28_2_APPS_ADDR A:0x1e00870
y.create.l HWIO_APPS_SMMU_SMR29_2_APPS_ADDR A:0x1e00874
y.create.l HWIO_APPS_SMMU_SMR30_2_APPS_ADDR A:0x1e00878
y.create.l HWIO_APPS_SMMU_SMR31_2_APPS_ADDR A:0x1e0087c
y.create.l HWIO_APPS_SMMU_S2CR0_2_APPS_ADDR A:0x1e00c00
y.create.l HWIO_APPS_SMMU_S2CR1_2_APPS_ADDR A:0x1e00c04
y.create.l HWIO_APPS_SMMU_S2CR2_2_APPS_ADDR A:0x1e00c08
y.create.l HWIO_APPS_SMMU_S2CR3_2_APPS_ADDR A:0x1e00c0c
y.create.l HWIO_APPS_SMMU_S2CR4_2_APPS_ADDR A:0x1e00c10
y.create.l HWIO_APPS_SMMU_S2CR5_2_APPS_ADDR A:0x1e00c14
y.create.l HWIO_APPS_SMMU_S2CR6_2_APPS_ADDR A:0x1e00c18
y.create.l HWIO_APPS_SMMU_S2CR7_2_APPS_ADDR A:0x1e00c1c
y.create.l HWIO_APPS_SMMU_S2CR8_2_APPS_ADDR A:0x1e00c20
y.create.l HWIO_APPS_SMMU_S2CR9_2_APPS_ADDR A:0x1e00c24
y.create.l HWIO_APPS_SMMU_S2CR10_2_APPS_ADDR A:0x1e00c28
y.create.l HWIO_APPS_SMMU_S2CR11_2_APPS_ADDR A:0x1e00c2c
y.create.l HWIO_APPS_SMMU_S2CR12_2_APPS_ADDR A:0x1e00c30
y.create.l HWIO_APPS_SMMU_S2CR13_2_APPS_ADDR A:0x1e00c34
y.create.l HWIO_APPS_SMMU_S2CR14_2_APPS_ADDR A:0x1e00c38
y.create.l HWIO_APPS_SMMU_S2CR15_2_APPS_ADDR A:0x1e00c3c
y.create.l HWIO_APPS_SMMU_S2CR16_2_APPS_ADDR A:0x1e00c40
y.create.l HWIO_APPS_SMMU_S2CR17_2_APPS_ADDR A:0x1e00c44
y.create.l HWIO_APPS_SMMU_S2CR18_2_APPS_ADDR A:0x1e00c48
y.create.l HWIO_APPS_SMMU_S2CR19_2_APPS_ADDR A:0x1e00c4c
y.create.l HWIO_APPS_SMMU_S2CR20_2_APPS_ADDR A:0x1e00c50
y.create.l HWIO_APPS_SMMU_S2CR21_2_APPS_ADDR A:0x1e00c54
y.create.l HWIO_APPS_SMMU_S2CR22_2_APPS_ADDR A:0x1e00c58
y.create.l HWIO_APPS_SMMU_S2CR23_2_APPS_ADDR A:0x1e00c5c
y.create.l HWIO_APPS_SMMU_S2CR24_2_APPS_ADDR A:0x1e00c60
y.create.l HWIO_APPS_SMMU_S2CR25_2_APPS_ADDR A:0x1e00c64
y.create.l HWIO_APPS_SMMU_S2CR26_2_APPS_ADDR A:0x1e00c68
y.create.l HWIO_APPS_SMMU_S2CR27_2_APPS_ADDR A:0x1e00c6c
y.create.l HWIO_APPS_SMMU_S2CR28_2_APPS_ADDR A:0x1e00c70
y.create.l HWIO_APPS_SMMU_S2CR29_2_APPS_ADDR A:0x1e00c74
y.create.l HWIO_APPS_SMMU_S2CR30_2_APPS_ADDR A:0x1e00c78
y.create.l HWIO_APPS_SMMU_S2CR31_2_APPS_ADDR A:0x1e00c7c
y.create.l HWIO_APPS_SMMU_PIDR0_2_APPS_ADDR A:0x1e00fe0
y.create.l HWIO_APPS_SMMU_PIDR1_2_APPS_ADDR A:0x1e00fe4
y.create.l HWIO_APPS_SMMU_PIDR2_2_APPS_ADDR A:0x1e00fe8
y.create.l HWIO_APPS_SMMU_PIDR3_2_APPS_ADDR A:0x1e00fec
y.create.l HWIO_APPS_SMMU_PIDR4_2_APPS_ADDR A:0x1e00fd0
y.create.l HWIO_APPS_SMMU_PIDR5_2_APPS_ADDR A:0x1e00fd4
y.create.l HWIO_APPS_SMMU_PIDR6_2_APPS_ADDR A:0x1e00fd8
y.create.l HWIO_APPS_SMMU_PIDR7_2_APPS_ADDR A:0x1e00fdc
y.create.l HWIO_APPS_SMMU_CIDR0_2_APPS_ADDR A:0x1e00ff0
y.create.l HWIO_APPS_SMMU_CIDR1_2_APPS_ADDR A:0x1e00ff4
y.create.l HWIO_APPS_SMMU_CIDR2_2_APPS_ADDR A:0x1e00ff8
y.create.l HWIO_APPS_SMMU_CIDR3_2_APPS_ADDR A:0x1e00ffc
y.create.l HWIO_APPS_SMMU_CBAR0_2_APPS_ADDR A:0x1e01000
y.create.l HWIO_APPS_SMMU_CBFRSYNRA0_2_APPS_ADDR A:0x1e01400
y.create.l HWIO_APPS_SMMU_CBA2R0_2_APPS_ADDR A:0x1e01800
y.create.l HWIO_APPS_SMMU_CBAR1_2_APPS_ADDR A:0x1e01004
y.create.l HWIO_APPS_SMMU_CBFRSYNRA1_2_APPS_ADDR A:0x1e01404
y.create.l HWIO_APPS_SMMU_CBA2R1_2_APPS_ADDR A:0x1e01804
y.create.l HWIO_APPS_SMMU_CBAR2_2_APPS_ADDR A:0x1e01008
y.create.l HWIO_APPS_SMMU_CBFRSYNRA2_2_APPS_ADDR A:0x1e01408
y.create.l HWIO_APPS_SMMU_CBA2R2_2_APPS_ADDR A:0x1e01808
y.create.l HWIO_APPS_SMMU_CBAR3_2_APPS_ADDR A:0x1e0100c
y.create.l HWIO_APPS_SMMU_CBFRSYNRA3_2_APPS_ADDR A:0x1e0140c
y.create.l HWIO_APPS_SMMU_CBA2R3_2_APPS_ADDR A:0x1e0180c
y.create.l HWIO_APPS_SMMU_CBAR4_2_APPS_ADDR A:0x1e01010
y.create.l HWIO_APPS_SMMU_CBFRSYNRA4_2_APPS_ADDR A:0x1e01410
y.create.l HWIO_APPS_SMMU_CBA2R4_2_APPS_ADDR A:0x1e01810
y.create.l HWIO_APPS_SMMU_CBAR5_2_APPS_ADDR A:0x1e01014
y.create.l HWIO_APPS_SMMU_CBFRSYNRA5_2_APPS_ADDR A:0x1e01414
y.create.l HWIO_APPS_SMMU_CBA2R5_2_APPS_ADDR A:0x1e01814
y.create.l HWIO_APPS_SMMU_CBAR6_2_APPS_ADDR A:0x1e01018
y.create.l HWIO_APPS_SMMU_CBFRSYNRA6_2_APPS_ADDR A:0x1e01418
y.create.l HWIO_APPS_SMMU_CBA2R6_2_APPS_ADDR A:0x1e01818
y.create.l HWIO_APPS_SMMU_CBAR7_2_APPS_ADDR A:0x1e0101c
y.create.l HWIO_APPS_SMMU_CBFRSYNRA7_2_APPS_ADDR A:0x1e0141c
y.create.l HWIO_APPS_SMMU_CBA2R7_2_APPS_ADDR A:0x1e0181c
y.create.l HWIO_APPS_SMMU_CBAR8_2_APPS_ADDR A:0x1e01020
y.create.l HWIO_APPS_SMMU_CBFRSYNRA8_2_APPS_ADDR A:0x1e01420
y.create.l HWIO_APPS_SMMU_CBA2R8_2_APPS_ADDR A:0x1e01820
y.create.l HWIO_APPS_SMMU_CBAR9_2_APPS_ADDR A:0x1e01024
y.create.l HWIO_APPS_SMMU_CBFRSYNRA9_2_APPS_ADDR A:0x1e01424
y.create.l HWIO_APPS_SMMU_CBA2R9_2_APPS_ADDR A:0x1e01824
y.create.l HWIO_APPS_SMMU_CBAR10_2_APPS_ADDR A:0x1e01028
y.create.l HWIO_APPS_SMMU_CBFRSYNRA10_2_APPS_ADDR A:0x1e01428
y.create.l HWIO_APPS_SMMU_CBA2R10_2_APPS_ADDR A:0x1e01828
y.create.l HWIO_APPS_SMMU_CBAR11_2_APPS_ADDR A:0x1e0102c
y.create.l HWIO_APPS_SMMU_CBFRSYNRA11_2_APPS_ADDR A:0x1e0142c
y.create.l HWIO_APPS_SMMU_CBA2R11_2_APPS_ADDR A:0x1e0182c
y.create.l HWIO_APPS_SMMU_CBAR12_2_APPS_ADDR A:0x1e01030
y.create.l HWIO_APPS_SMMU_CBFRSYNRA12_2_APPS_ADDR A:0x1e01430
y.create.l HWIO_APPS_SMMU_CBA2R12_2_APPS_ADDR A:0x1e01830
y.create.l HWIO_APPS_SMMU_CBAR13_2_APPS_ADDR A:0x1e01034
y.create.l HWIO_APPS_SMMU_CBFRSYNRA13_2_APPS_ADDR A:0x1e01434
y.create.l HWIO_APPS_SMMU_CBA2R13_2_APPS_ADDR A:0x1e01834
y.create.l HWIO_APPS_SMMU_CBAR14_2_APPS_ADDR A:0x1e01038
y.create.l HWIO_APPS_SMMU_CBFRSYNRA14_2_APPS_ADDR A:0x1e01438
y.create.l HWIO_APPS_SMMU_CBA2R14_2_APPS_ADDR A:0x1e01838
y.create.l HWIO_APPS_SMMU_CBAR15_2_APPS_ADDR A:0x1e0103c
y.create.l HWIO_APPS_SMMU_CBFRSYNRA15_2_APPS_ADDR A:0x1e0143c
y.create.l HWIO_APPS_SMMU_CBA2R15_2_APPS_ADDR A:0x1e0183c
y.create.l HWIO_APPS_PMEVCNTR0_2_APPS_ADDR A:0x1e03000
y.create.l HWIO_APPS_PMEVCNTR1_2_APPS_ADDR A:0x1e03004
y.create.l HWIO_APPS_PMEVCNTR2_2_APPS_ADDR A:0x1e03008
y.create.l HWIO_APPS_PMEVCNTR3_2_APPS_ADDR A:0x1e0300c
y.create.l HWIO_APPS_PMEVCNTR4_2_APPS_ADDR A:0x1e03010
y.create.l HWIO_APPS_PMEVCNTR5_2_APPS_ADDR A:0x1e03014
y.create.l HWIO_APPS_PMEVCNTR6_2_APPS_ADDR A:0x1e03018
y.create.l HWIO_APPS_PMEVCNTR7_2_APPS_ADDR A:0x1e0301c
y.create.l HWIO_APPS_PMEVCNTR8_2_APPS_ADDR A:0x1e03020
y.create.l HWIO_APPS_PMEVCNTR9_2_APPS_ADDR A:0x1e03024
y.create.l HWIO_APPS_PMEVCNTR10_2_APPS_ADDR A:0x1e03028
y.create.l HWIO_APPS_PMEVCNTR11_2_APPS_ADDR A:0x1e0302c
y.create.l HWIO_APPS_PMEVTYPER0_2_APPS_ADDR A:0x1e03400
y.create.l HWIO_APPS_PMEVTYPER1_2_APPS_ADDR A:0x1e03404
y.create.l HWIO_APPS_PMEVTYPER2_2_APPS_ADDR A:0x1e03408
y.create.l HWIO_APPS_PMEVTYPER3_2_APPS_ADDR A:0x1e0340c
y.create.l HWIO_APPS_PMEVTYPER4_2_APPS_ADDR A:0x1e03410
y.create.l HWIO_APPS_PMEVTYPER5_2_APPS_ADDR A:0x1e03414
y.create.l HWIO_APPS_PMEVTYPER6_2_APPS_ADDR A:0x1e03418
y.create.l HWIO_APPS_PMEVTYPER7_2_APPS_ADDR A:0x1e0341c
y.create.l HWIO_APPS_PMEVTYPER8_2_APPS_ADDR A:0x1e03420
y.create.l HWIO_APPS_PMEVTYPER9_2_APPS_ADDR A:0x1e03424
y.create.l HWIO_APPS_PMEVTYPER10_2_APPS_ADDR A:0x1e03428
y.create.l HWIO_APPS_PMEVTYPER11_2_APPS_ADDR A:0x1e0342c
y.create.l HWIO_APPS_PMCGCR0_2_APPS_ADDR A:0x1e03800
y.create.l HWIO_APPS_PMCGCR1_2_APPS_ADDR A:0x1e03804
y.create.l HWIO_APPS_PMCGCR2_2_APPS_ADDR A:0x1e03808
y.create.l HWIO_APPS_PMCGSMR0_2_APPS_ADDR A:0x1e03a00
y.create.l HWIO_APPS_PMCGSMR1_2_APPS_ADDR A:0x1e03a04
y.create.l HWIO_APPS_PMCGSMR2_2_APPS_ADDR A:0x1e03a08
y.create.l HWIO_APPS_PMCNTENSET_2_APPS_ADDR A:0x1e03c00
y.create.l HWIO_APPS_PMCNTENCLR_2_APPS_ADDR A:0x1e03c20
y.create.l HWIO_APPS_PMINTENSET_2_APPS_ADDR A:0x1e03c40
y.create.l HWIO_APPS_PMINTENCLR_2_APPS_ADDR A:0x1e03c60
y.create.l HWIO_APPS_PMOVSCLR_2_APPS_ADDR A:0x1e03c80
y.create.l HWIO_APPS_PMOVSSET_2_APPS_ADDR A:0x1e03cc0
y.create.l HWIO_APPS_PMCFGR_2_APPS_ADDR A:0x1e03e00
y.create.l HWIO_APPS_PMCR_2_APPS_ADDR A:0x1e03e04
y.create.l HWIO_APPS_PMCEID0_2_APPS_ADDR A:0x1e03e20
y.create.l HWIO_APPS_PMAUTHSTATUS_2_APPS_ADDR A:0x1e03fb8
y.create.l HWIO_APPS_PMDEVTYPE_2_APPS_ADDR A:0x1e03fcc
y.create.l HWIO_APPS_SMMU_CB0_SCTLR_2_APPS_ADDR A:0x1e10000
y.create.l HWIO_APPS_SMMU_CB1_SCTLR_2_APPS_ADDR A:0x1e11000
y.create.l HWIO_APPS_SMMU_CB2_SCTLR_2_APPS_ADDR A:0x1e12000
y.create.l HWIO_APPS_SMMU_CB3_SCTLR_2_APPS_ADDR A:0x1e13000
y.create.l HWIO_APPS_SMMU_CB4_SCTLR_2_APPS_ADDR A:0x1e14000
y.create.l HWIO_APPS_SMMU_CB5_SCTLR_2_APPS_ADDR A:0x1e15000
y.create.l HWIO_APPS_SMMU_CB6_SCTLR_2_APPS_ADDR A:0x1e16000
y.create.l HWIO_APPS_SMMU_CB7_SCTLR_2_APPS_ADDR A:0x1e17000
y.create.l HWIO_APPS_SMMU_CB8_SCTLR_2_APPS_ADDR A:0x1e18000
y.create.l HWIO_APPS_SMMU_CB9_SCTLR_2_APPS_ADDR A:0x1e19000
y.create.l HWIO_APPS_SMMU_CB10_SCTLR_2_APPS_ADDR A:0x1e1a000
y.create.l HWIO_APPS_SMMU_CB11_SCTLR_2_APPS_ADDR A:0x1e1b000
y.create.l HWIO_APPS_SMMU_CB12_SCTLR_2_APPS_ADDR A:0x1e1c000
y.create.l HWIO_APPS_SMMU_CB13_SCTLR_2_APPS_ADDR A:0x1e1d000
y.create.l HWIO_APPS_SMMU_CB14_SCTLR_2_APPS_ADDR A:0x1e1e000
y.create.l HWIO_APPS_SMMU_CB15_SCTLR_2_APPS_ADDR A:0x1e1f000
y.create.l HWIO_APPS_SMMU_CB0_ACTLR_2_APPS_ADDR A:0x1e10004
y.create.l HWIO_APPS_SMMU_CB1_ACTLR_2_APPS_ADDR A:0x1e11004
y.create.l HWIO_APPS_SMMU_CB2_ACTLR_2_APPS_ADDR A:0x1e12004
y.create.l HWIO_APPS_SMMU_CB3_ACTLR_2_APPS_ADDR A:0x1e13004
y.create.l HWIO_APPS_SMMU_CB4_ACTLR_2_APPS_ADDR A:0x1e14004
y.create.l HWIO_APPS_SMMU_CB5_ACTLR_2_APPS_ADDR A:0x1e15004
y.create.l HWIO_APPS_SMMU_CB6_ACTLR_2_APPS_ADDR A:0x1e16004
y.create.l HWIO_APPS_SMMU_CB7_ACTLR_2_APPS_ADDR A:0x1e17004
y.create.l HWIO_APPS_SMMU_CB8_ACTLR_2_APPS_ADDR A:0x1e18004
y.create.l HWIO_APPS_SMMU_CB9_ACTLR_2_APPS_ADDR A:0x1e19004
y.create.l HWIO_APPS_SMMU_CB10_ACTLR_2_APPS_ADDR A:0x1e1a004
y.create.l HWIO_APPS_SMMU_CB11_ACTLR_2_APPS_ADDR A:0x1e1b004
y.create.l HWIO_APPS_SMMU_CB12_ACTLR_2_APPS_ADDR A:0x1e1c004
y.create.l HWIO_APPS_SMMU_CB13_ACTLR_2_APPS_ADDR A:0x1e1d004
y.create.l HWIO_APPS_SMMU_CB14_ACTLR_2_APPS_ADDR A:0x1e1e004
y.create.l HWIO_APPS_SMMU_CB15_ACTLR_2_APPS_ADDR A:0x1e1f004
y.create.l HWIO_APPS_SMMU_CB0_RESUME_2_APPS_ADDR A:0x1e10008
y.create.l HWIO_APPS_SMMU_CB1_RESUME_2_APPS_ADDR A:0x1e11008
y.create.l HWIO_APPS_SMMU_CB2_RESUME_2_APPS_ADDR A:0x1e12008
y.create.l HWIO_APPS_SMMU_CB3_RESUME_2_APPS_ADDR A:0x1e13008
y.create.l HWIO_APPS_SMMU_CB4_RESUME_2_APPS_ADDR A:0x1e14008
y.create.l HWIO_APPS_SMMU_CB5_RESUME_2_APPS_ADDR A:0x1e15008
y.create.l HWIO_APPS_SMMU_CB6_RESUME_2_APPS_ADDR A:0x1e16008
y.create.l HWIO_APPS_SMMU_CB7_RESUME_2_APPS_ADDR A:0x1e17008
y.create.l HWIO_APPS_SMMU_CB8_RESUME_2_APPS_ADDR A:0x1e18008
y.create.l HWIO_APPS_SMMU_CB9_RESUME_2_APPS_ADDR A:0x1e19008
y.create.l HWIO_APPS_SMMU_CB10_RESUME_2_APPS_ADDR A:0x1e1a008
y.create.l HWIO_APPS_SMMU_CB11_RESUME_2_APPS_ADDR A:0x1e1b008
y.create.l HWIO_APPS_SMMU_CB12_RESUME_2_APPS_ADDR A:0x1e1c008
y.create.l HWIO_APPS_SMMU_CB13_RESUME_2_APPS_ADDR A:0x1e1d008
y.create.l HWIO_APPS_SMMU_CB14_RESUME_2_APPS_ADDR A:0x1e1e008
y.create.l HWIO_APPS_SMMU_CB15_RESUME_2_APPS_ADDR A:0x1e1f008
y.create.l HWIO_APPS_SMMU_CB0_TCR2_2_APPS_ADDR A:0x1e10010
y.create.l HWIO_APPS_SMMU_CB1_TCR2_2_APPS_ADDR A:0x1e11010
y.create.l HWIO_APPS_SMMU_CB2_TCR2_2_APPS_ADDR A:0x1e12010
y.create.l HWIO_APPS_SMMU_CB3_TCR2_2_APPS_ADDR A:0x1e13010
y.create.l HWIO_APPS_SMMU_CB4_TCR2_2_APPS_ADDR A:0x1e14010
y.create.l HWIO_APPS_SMMU_CB5_TCR2_2_APPS_ADDR A:0x1e15010
y.create.l HWIO_APPS_SMMU_CB6_TCR2_2_APPS_ADDR A:0x1e16010
y.create.l HWIO_APPS_SMMU_CB7_TCR2_2_APPS_ADDR A:0x1e17010
y.create.l HWIO_APPS_SMMU_CB8_TCR2_2_APPS_ADDR A:0x1e18010
y.create.l HWIO_APPS_SMMU_CB9_TCR2_2_APPS_ADDR A:0x1e19010
y.create.l HWIO_APPS_SMMU_CB10_TCR2_2_APPS_ADDR A:0x1e1a010
y.create.l HWIO_APPS_SMMU_CB11_TCR2_2_APPS_ADDR A:0x1e1b010
y.create.l HWIO_APPS_SMMU_CB12_TCR2_2_APPS_ADDR A:0x1e1c010
y.create.l HWIO_APPS_SMMU_CB13_TCR2_2_APPS_ADDR A:0x1e1d010
y.create.l HWIO_APPS_SMMU_CB14_TCR2_2_APPS_ADDR A:0x1e1e010
y.create.l HWIO_APPS_SMMU_CB15_TCR2_2_APPS_ADDR A:0x1e1f010
y.create.l HWIO_APPS_SMMU_CB0_TTBR0_LOW_2_APPS_ADDR A:0x1e10020
y.create.l HWIO_APPS_SMMU_CB1_TTBR0_LOW_2_APPS_ADDR A:0x1e11020
y.create.l HWIO_APPS_SMMU_CB2_TTBR0_LOW_2_APPS_ADDR A:0x1e12020
y.create.l HWIO_APPS_SMMU_CB3_TTBR0_LOW_2_APPS_ADDR A:0x1e13020
y.create.l HWIO_APPS_SMMU_CB4_TTBR0_LOW_2_APPS_ADDR A:0x1e14020
y.create.l HWIO_APPS_SMMU_CB5_TTBR0_LOW_2_APPS_ADDR A:0x1e15020
y.create.l HWIO_APPS_SMMU_CB6_TTBR0_LOW_2_APPS_ADDR A:0x1e16020
y.create.l HWIO_APPS_SMMU_CB7_TTBR0_LOW_2_APPS_ADDR A:0x1e17020
y.create.l HWIO_APPS_SMMU_CB8_TTBR0_LOW_2_APPS_ADDR A:0x1e18020
y.create.l HWIO_APPS_SMMU_CB9_TTBR0_LOW_2_APPS_ADDR A:0x1e19020
y.create.l HWIO_APPS_SMMU_CB10_TTBR0_LOW_2_APPS_ADDR A:0x1e1a020
y.create.l HWIO_APPS_SMMU_CB11_TTBR0_LOW_2_APPS_ADDR A:0x1e1b020
y.create.l HWIO_APPS_SMMU_CB12_TTBR0_LOW_2_APPS_ADDR A:0x1e1c020
y.create.l HWIO_APPS_SMMU_CB13_TTBR0_LOW_2_APPS_ADDR A:0x1e1d020
y.create.l HWIO_APPS_SMMU_CB14_TTBR0_LOW_2_APPS_ADDR A:0x1e1e020
y.create.l HWIO_APPS_SMMU_CB15_TTBR0_LOW_2_APPS_ADDR A:0x1e1f020
y.create.l HWIO_APPS_SMMU_CB0_TTBR0_HIGH_2_APPS_ADDR A:0x1e10024
y.create.l HWIO_APPS_SMMU_CB1_TTBR0_HIGH_2_APPS_ADDR A:0x1e11024
y.create.l HWIO_APPS_SMMU_CB2_TTBR0_HIGH_2_APPS_ADDR A:0x1e12024
y.create.l HWIO_APPS_SMMU_CB3_TTBR0_HIGH_2_APPS_ADDR A:0x1e13024
y.create.l HWIO_APPS_SMMU_CB4_TTBR0_HIGH_2_APPS_ADDR A:0x1e14024
y.create.l HWIO_APPS_SMMU_CB5_TTBR0_HIGH_2_APPS_ADDR A:0x1e15024
y.create.l HWIO_APPS_SMMU_CB6_TTBR0_HIGH_2_APPS_ADDR A:0x1e16024
y.create.l HWIO_APPS_SMMU_CB7_TTBR0_HIGH_2_APPS_ADDR A:0x1e17024
y.create.l HWIO_APPS_SMMU_CB8_TTBR0_HIGH_2_APPS_ADDR A:0x1e18024
y.create.l HWIO_APPS_SMMU_CB9_TTBR0_HIGH_2_APPS_ADDR A:0x1e19024
y.create.l HWIO_APPS_SMMU_CB10_TTBR0_HIGH_2_APPS_ADDR A:0x1e1a024
y.create.l HWIO_APPS_SMMU_CB11_TTBR0_HIGH_2_APPS_ADDR A:0x1e1b024
y.create.l HWIO_APPS_SMMU_CB12_TTBR0_HIGH_2_APPS_ADDR A:0x1e1c024
y.create.l HWIO_APPS_SMMU_CB13_TTBR0_HIGH_2_APPS_ADDR A:0x1e1d024
y.create.l HWIO_APPS_SMMU_CB14_TTBR0_HIGH_2_APPS_ADDR A:0x1e1e024
y.create.l HWIO_APPS_SMMU_CB15_TTBR0_HIGH_2_APPS_ADDR A:0x1e1f024
y.create.l HWIO_APPS_SMMU_CB0_TTBR1_LOW_2_APPS_ADDR A:0x1e10028
y.create.l HWIO_APPS_SMMU_CB1_TTBR1_LOW_2_APPS_ADDR A:0x1e11028
y.create.l HWIO_APPS_SMMU_CB2_TTBR1_LOW_2_APPS_ADDR A:0x1e12028
y.create.l HWIO_APPS_SMMU_CB3_TTBR1_LOW_2_APPS_ADDR A:0x1e13028
y.create.l HWIO_APPS_SMMU_CB4_TTBR1_LOW_2_APPS_ADDR A:0x1e14028
y.create.l HWIO_APPS_SMMU_CB5_TTBR1_LOW_2_APPS_ADDR A:0x1e15028
y.create.l HWIO_APPS_SMMU_CB6_TTBR1_LOW_2_APPS_ADDR A:0x1e16028
y.create.l HWIO_APPS_SMMU_CB7_TTBR1_LOW_2_APPS_ADDR A:0x1e17028
y.create.l HWIO_APPS_SMMU_CB8_TTBR1_LOW_2_APPS_ADDR A:0x1e18028
y.create.l HWIO_APPS_SMMU_CB9_TTBR1_LOW_2_APPS_ADDR A:0x1e19028
y.create.l HWIO_APPS_SMMU_CB10_TTBR1_LOW_2_APPS_ADDR A:0x1e1a028
y.create.l HWIO_APPS_SMMU_CB11_TTBR1_LOW_2_APPS_ADDR A:0x1e1b028
y.create.l HWIO_APPS_SMMU_CB12_TTBR1_LOW_2_APPS_ADDR A:0x1e1c028
y.create.l HWIO_APPS_SMMU_CB13_TTBR1_LOW_2_APPS_ADDR A:0x1e1d028
y.create.l HWIO_APPS_SMMU_CB14_TTBR1_LOW_2_APPS_ADDR A:0x1e1e028
y.create.l HWIO_APPS_SMMU_CB15_TTBR1_LOW_2_APPS_ADDR A:0x1e1f028
y.create.l HWIO_APPS_SMMU_CB0_TTBR1_HIGH_2_APPS_ADDR A:0x1e1002c
y.create.l HWIO_APPS_SMMU_CB1_TTBR1_HIGH_2_APPS_ADDR A:0x1e1102c
y.create.l HWIO_APPS_SMMU_CB2_TTBR1_HIGH_2_APPS_ADDR A:0x1e1202c
y.create.l HWIO_APPS_SMMU_CB3_TTBR1_HIGH_2_APPS_ADDR A:0x1e1302c
y.create.l HWIO_APPS_SMMU_CB4_TTBR1_HIGH_2_APPS_ADDR A:0x1e1402c
y.create.l HWIO_APPS_SMMU_CB5_TTBR1_HIGH_2_APPS_ADDR A:0x1e1502c
y.create.l HWIO_APPS_SMMU_CB6_TTBR1_HIGH_2_APPS_ADDR A:0x1e1602c
y.create.l HWIO_APPS_SMMU_CB7_TTBR1_HIGH_2_APPS_ADDR A:0x1e1702c
y.create.l HWIO_APPS_SMMU_CB8_TTBR1_HIGH_2_APPS_ADDR A:0x1e1802c
y.create.l HWIO_APPS_SMMU_CB9_TTBR1_HIGH_2_APPS_ADDR A:0x1e1902c
y.create.l HWIO_APPS_SMMU_CB10_TTBR1_HIGH_2_APPS_ADDR A:0x1e1a02c
y.create.l HWIO_APPS_SMMU_CB11_TTBR1_HIGH_2_APPS_ADDR A:0x1e1b02c
y.create.l HWIO_APPS_SMMU_CB12_TTBR1_HIGH_2_APPS_ADDR A:0x1e1c02c
y.create.l HWIO_APPS_SMMU_CB13_TTBR1_HIGH_2_APPS_ADDR A:0x1e1d02c
y.create.l HWIO_APPS_SMMU_CB14_TTBR1_HIGH_2_APPS_ADDR A:0x1e1e02c
y.create.l HWIO_APPS_SMMU_CB15_TTBR1_HIGH_2_APPS_ADDR A:0x1e1f02c
y.create.l HWIO_APPS_SMMU_CB0_TCR_LPAE_2_APPS_ADDR A:0x1e10030
y.create.l HWIO_APPS_SMMU_CB1_TCR_LPAE_2_APPS_ADDR A:0x1e11030
y.create.l HWIO_APPS_SMMU_CB2_TCR_LPAE_2_APPS_ADDR A:0x1e12030
y.create.l HWIO_APPS_SMMU_CB3_TCR_LPAE_2_APPS_ADDR A:0x1e13030
y.create.l HWIO_APPS_SMMU_CB4_TCR_LPAE_2_APPS_ADDR A:0x1e14030
y.create.l HWIO_APPS_SMMU_CB5_TCR_LPAE_2_APPS_ADDR A:0x1e15030
y.create.l HWIO_APPS_SMMU_CB6_TCR_LPAE_2_APPS_ADDR A:0x1e16030
y.create.l HWIO_APPS_SMMU_CB7_TCR_LPAE_2_APPS_ADDR A:0x1e17030
y.create.l HWIO_APPS_SMMU_CB8_TCR_LPAE_2_APPS_ADDR A:0x1e18030
y.create.l HWIO_APPS_SMMU_CB9_TCR_LPAE_2_APPS_ADDR A:0x1e19030
y.create.l HWIO_APPS_SMMU_CB10_TCR_LPAE_2_APPS_ADDR A:0x1e1a030
y.create.l HWIO_APPS_SMMU_CB11_TCR_LPAE_2_APPS_ADDR A:0x1e1b030
y.create.l HWIO_APPS_SMMU_CB12_TCR_LPAE_2_APPS_ADDR A:0x1e1c030
y.create.l HWIO_APPS_SMMU_CB13_TCR_LPAE_2_APPS_ADDR A:0x1e1d030
y.create.l HWIO_APPS_SMMU_CB14_TCR_LPAE_2_APPS_ADDR A:0x1e1e030
y.create.l HWIO_APPS_SMMU_CB15_TCR_LPAE_2_APPS_ADDR A:0x1e1f030
y.create.l HWIO_APPS_SMMU_CB0_CONTEXTIDR_2_APPS_ADDR A:0x1e10034
y.create.l HWIO_APPS_SMMU_CB1_CONTEXTIDR_2_APPS_ADDR A:0x1e11034
y.create.l HWIO_APPS_SMMU_CB2_CONTEXTIDR_2_APPS_ADDR A:0x1e12034
y.create.l HWIO_APPS_SMMU_CB3_CONTEXTIDR_2_APPS_ADDR A:0x1e13034
y.create.l HWIO_APPS_SMMU_CB4_CONTEXTIDR_2_APPS_ADDR A:0x1e14034
y.create.l HWIO_APPS_SMMU_CB5_CONTEXTIDR_2_APPS_ADDR A:0x1e15034
y.create.l HWIO_APPS_SMMU_CB6_CONTEXTIDR_2_APPS_ADDR A:0x1e16034
y.create.l HWIO_APPS_SMMU_CB7_CONTEXTIDR_2_APPS_ADDR A:0x1e17034
y.create.l HWIO_APPS_SMMU_CB8_CONTEXTIDR_2_APPS_ADDR A:0x1e18034
y.create.l HWIO_APPS_SMMU_CB9_CONTEXTIDR_2_APPS_ADDR A:0x1e19034
y.create.l HWIO_APPS_SMMU_CB10_CONTEXTIDR_2_APPS_ADDR A:0x1e1a034
y.create.l HWIO_APPS_SMMU_CB11_CONTEXTIDR_2_APPS_ADDR A:0x1e1b034
y.create.l HWIO_APPS_SMMU_CB12_CONTEXTIDR_2_APPS_ADDR A:0x1e1c034
y.create.l HWIO_APPS_SMMU_CB13_CONTEXTIDR_2_APPS_ADDR A:0x1e1d034
y.create.l HWIO_APPS_SMMU_CB14_CONTEXTIDR_2_APPS_ADDR A:0x1e1e034
y.create.l HWIO_APPS_SMMU_CB15_CONTEXTIDR_2_APPS_ADDR A:0x1e1f034
y.create.l HWIO_APPS_SMMU_CB0_PRRR_MAIR0_2_APPS_ADDR A:0x1e10038
y.create.l HWIO_APPS_SMMU_CB1_PRRR_MAIR0_2_APPS_ADDR A:0x1e11038
y.create.l HWIO_APPS_SMMU_CB2_PRRR_MAIR0_2_APPS_ADDR A:0x1e12038
y.create.l HWIO_APPS_SMMU_CB3_PRRR_MAIR0_2_APPS_ADDR A:0x1e13038
y.create.l HWIO_APPS_SMMU_CB4_PRRR_MAIR0_2_APPS_ADDR A:0x1e14038
y.create.l HWIO_APPS_SMMU_CB5_PRRR_MAIR0_2_APPS_ADDR A:0x1e15038
y.create.l HWIO_APPS_SMMU_CB6_PRRR_MAIR0_2_APPS_ADDR A:0x1e16038
y.create.l HWIO_APPS_SMMU_CB7_PRRR_MAIR0_2_APPS_ADDR A:0x1e17038
y.create.l HWIO_APPS_SMMU_CB8_PRRR_MAIR0_2_APPS_ADDR A:0x1e18038
y.create.l HWIO_APPS_SMMU_CB9_PRRR_MAIR0_2_APPS_ADDR A:0x1e19038
y.create.l HWIO_APPS_SMMU_CB10_PRRR_MAIR0_2_APPS_ADDR A:0x1e1a038
y.create.l HWIO_APPS_SMMU_CB11_PRRR_MAIR0_2_APPS_ADDR A:0x1e1b038
y.create.l HWIO_APPS_SMMU_CB12_PRRR_MAIR0_2_APPS_ADDR A:0x1e1c038
y.create.l HWIO_APPS_SMMU_CB13_PRRR_MAIR0_2_APPS_ADDR A:0x1e1d038
y.create.l HWIO_APPS_SMMU_CB14_PRRR_MAIR0_2_APPS_ADDR A:0x1e1e038
y.create.l HWIO_APPS_SMMU_CB15_PRRR_MAIR0_2_APPS_ADDR A:0x1e1f038
y.create.l HWIO_APPS_SMMU_CB0_NMRR_MAIR1_2_APPS_ADDR A:0x1e1003c
y.create.l HWIO_APPS_SMMU_CB1_NMRR_MAIR1_2_APPS_ADDR A:0x1e1103c
y.create.l HWIO_APPS_SMMU_CB2_NMRR_MAIR1_2_APPS_ADDR A:0x1e1203c
y.create.l HWIO_APPS_SMMU_CB3_NMRR_MAIR1_2_APPS_ADDR A:0x1e1303c
y.create.l HWIO_APPS_SMMU_CB4_NMRR_MAIR1_2_APPS_ADDR A:0x1e1403c
y.create.l HWIO_APPS_SMMU_CB5_NMRR_MAIR1_2_APPS_ADDR A:0x1e1503c
y.create.l HWIO_APPS_SMMU_CB6_NMRR_MAIR1_2_APPS_ADDR A:0x1e1603c
y.create.l HWIO_APPS_SMMU_CB7_NMRR_MAIR1_2_APPS_ADDR A:0x1e1703c
y.create.l HWIO_APPS_SMMU_CB8_NMRR_MAIR1_2_APPS_ADDR A:0x1e1803c
y.create.l HWIO_APPS_SMMU_CB9_NMRR_MAIR1_2_APPS_ADDR A:0x1e1903c
y.create.l HWIO_APPS_SMMU_CB10_NMRR_MAIR1_2_APPS_ADDR A:0x1e1a03c
y.create.l HWIO_APPS_SMMU_CB11_NMRR_MAIR1_2_APPS_ADDR A:0x1e1b03c
y.create.l HWIO_APPS_SMMU_CB12_NMRR_MAIR1_2_APPS_ADDR A:0x1e1c03c
y.create.l HWIO_APPS_SMMU_CB13_NMRR_MAIR1_2_APPS_ADDR A:0x1e1d03c
y.create.l HWIO_APPS_SMMU_CB14_NMRR_MAIR1_2_APPS_ADDR A:0x1e1e03c
y.create.l HWIO_APPS_SMMU_CB15_NMRR_MAIR1_2_APPS_ADDR A:0x1e1f03c
y.create.l HWIO_APPS_SMMU_CB0_FSR_2_APPS_ADDR A:0x1e10058
y.create.l HWIO_APPS_SMMU_CB1_FSR_2_APPS_ADDR A:0x1e11058
y.create.l HWIO_APPS_SMMU_CB2_FSR_2_APPS_ADDR A:0x1e12058
y.create.l HWIO_APPS_SMMU_CB3_FSR_2_APPS_ADDR A:0x1e13058
y.create.l HWIO_APPS_SMMU_CB4_FSR_2_APPS_ADDR A:0x1e14058
y.create.l HWIO_APPS_SMMU_CB5_FSR_2_APPS_ADDR A:0x1e15058
y.create.l HWIO_APPS_SMMU_CB6_FSR_2_APPS_ADDR A:0x1e16058
y.create.l HWIO_APPS_SMMU_CB7_FSR_2_APPS_ADDR A:0x1e17058
y.create.l HWIO_APPS_SMMU_CB8_FSR_2_APPS_ADDR A:0x1e18058
y.create.l HWIO_APPS_SMMU_CB9_FSR_2_APPS_ADDR A:0x1e19058
y.create.l HWIO_APPS_SMMU_CB10_FSR_2_APPS_ADDR A:0x1e1a058
y.create.l HWIO_APPS_SMMU_CB11_FSR_2_APPS_ADDR A:0x1e1b058
y.create.l HWIO_APPS_SMMU_CB12_FSR_2_APPS_ADDR A:0x1e1c058
y.create.l HWIO_APPS_SMMU_CB13_FSR_2_APPS_ADDR A:0x1e1d058
y.create.l HWIO_APPS_SMMU_CB14_FSR_2_APPS_ADDR A:0x1e1e058
y.create.l HWIO_APPS_SMMU_CB15_FSR_2_APPS_ADDR A:0x1e1f058
y.create.l HWIO_APPS_SMMU_CB0_FSRRESTORE_2_APPS_ADDR A:0x1e1005c
y.create.l HWIO_APPS_SMMU_CB1_FSRRESTORE_2_APPS_ADDR A:0x1e1105c
y.create.l HWIO_APPS_SMMU_CB2_FSRRESTORE_2_APPS_ADDR A:0x1e1205c
y.create.l HWIO_APPS_SMMU_CB3_FSRRESTORE_2_APPS_ADDR A:0x1e1305c
y.create.l HWIO_APPS_SMMU_CB4_FSRRESTORE_2_APPS_ADDR A:0x1e1405c
y.create.l HWIO_APPS_SMMU_CB5_FSRRESTORE_2_APPS_ADDR A:0x1e1505c
y.create.l HWIO_APPS_SMMU_CB6_FSRRESTORE_2_APPS_ADDR A:0x1e1605c
y.create.l HWIO_APPS_SMMU_CB7_FSRRESTORE_2_APPS_ADDR A:0x1e1705c
y.create.l HWIO_APPS_SMMU_CB8_FSRRESTORE_2_APPS_ADDR A:0x1e1805c
y.create.l HWIO_APPS_SMMU_CB9_FSRRESTORE_2_APPS_ADDR A:0x1e1905c
y.create.l HWIO_APPS_SMMU_CB10_FSRRESTORE_2_APPS_ADDR A:0x1e1a05c
y.create.l HWIO_APPS_SMMU_CB11_FSRRESTORE_2_APPS_ADDR A:0x1e1b05c
y.create.l HWIO_APPS_SMMU_CB12_FSRRESTORE_2_APPS_ADDR A:0x1e1c05c
y.create.l HWIO_APPS_SMMU_CB13_FSRRESTORE_2_APPS_ADDR A:0x1e1d05c
y.create.l HWIO_APPS_SMMU_CB14_FSRRESTORE_2_APPS_ADDR A:0x1e1e05c
y.create.l HWIO_APPS_SMMU_CB15_FSRRESTORE_2_APPS_ADDR A:0x1e1f05c
y.create.l HWIO_APPS_SMMU_CB0_FAR_LOW_2_APPS_ADDR A:0x1e10060
y.create.l HWIO_APPS_SMMU_CB1_FAR_LOW_2_APPS_ADDR A:0x1e11060
y.create.l HWIO_APPS_SMMU_CB2_FAR_LOW_2_APPS_ADDR A:0x1e12060
y.create.l HWIO_APPS_SMMU_CB3_FAR_LOW_2_APPS_ADDR A:0x1e13060
y.create.l HWIO_APPS_SMMU_CB4_FAR_LOW_2_APPS_ADDR A:0x1e14060
y.create.l HWIO_APPS_SMMU_CB5_FAR_LOW_2_APPS_ADDR A:0x1e15060
y.create.l HWIO_APPS_SMMU_CB6_FAR_LOW_2_APPS_ADDR A:0x1e16060
y.create.l HWIO_APPS_SMMU_CB7_FAR_LOW_2_APPS_ADDR A:0x1e17060
y.create.l HWIO_APPS_SMMU_CB8_FAR_LOW_2_APPS_ADDR A:0x1e18060
y.create.l HWIO_APPS_SMMU_CB9_FAR_LOW_2_APPS_ADDR A:0x1e19060
y.create.l HWIO_APPS_SMMU_CB10_FAR_LOW_2_APPS_ADDR A:0x1e1a060
y.create.l HWIO_APPS_SMMU_CB11_FAR_LOW_2_APPS_ADDR A:0x1e1b060
y.create.l HWIO_APPS_SMMU_CB12_FAR_LOW_2_APPS_ADDR A:0x1e1c060
y.create.l HWIO_APPS_SMMU_CB13_FAR_LOW_2_APPS_ADDR A:0x1e1d060
y.create.l HWIO_APPS_SMMU_CB14_FAR_LOW_2_APPS_ADDR A:0x1e1e060
y.create.l HWIO_APPS_SMMU_CB15_FAR_LOW_2_APPS_ADDR A:0x1e1f060
y.create.l HWIO_APPS_SMMU_CB0_FAR_HIGH_2_APPS_ADDR A:0x1e10064
y.create.l HWIO_APPS_SMMU_CB1_FAR_HIGH_2_APPS_ADDR A:0x1e11064
y.create.l HWIO_APPS_SMMU_CB2_FAR_HIGH_2_APPS_ADDR A:0x1e12064
y.create.l HWIO_APPS_SMMU_CB3_FAR_HIGH_2_APPS_ADDR A:0x1e13064
y.create.l HWIO_APPS_SMMU_CB4_FAR_HIGH_2_APPS_ADDR A:0x1e14064
y.create.l HWIO_APPS_SMMU_CB5_FAR_HIGH_2_APPS_ADDR A:0x1e15064
y.create.l HWIO_APPS_SMMU_CB6_FAR_HIGH_2_APPS_ADDR A:0x1e16064
y.create.l HWIO_APPS_SMMU_CB7_FAR_HIGH_2_APPS_ADDR A:0x1e17064
y.create.l HWIO_APPS_SMMU_CB8_FAR_HIGH_2_APPS_ADDR A:0x1e18064
y.create.l HWIO_APPS_SMMU_CB9_FAR_HIGH_2_APPS_ADDR A:0x1e19064
y.create.l HWIO_APPS_SMMU_CB10_FAR_HIGH_2_APPS_ADDR A:0x1e1a064
y.create.l HWIO_APPS_SMMU_CB11_FAR_HIGH_2_APPS_ADDR A:0x1e1b064
y.create.l HWIO_APPS_SMMU_CB12_FAR_HIGH_2_APPS_ADDR A:0x1e1c064
y.create.l HWIO_APPS_SMMU_CB13_FAR_HIGH_2_APPS_ADDR A:0x1e1d064
y.create.l HWIO_APPS_SMMU_CB14_FAR_HIGH_2_APPS_ADDR A:0x1e1e064
y.create.l HWIO_APPS_SMMU_CB15_FAR_HIGH_2_APPS_ADDR A:0x1e1f064
y.create.l HWIO_APPS_SMMU_CB0_FSYNR0_2_APPS_ADDR A:0x1e10068
y.create.l HWIO_APPS_SMMU_CB1_FSYNR0_2_APPS_ADDR A:0x1e11068
y.create.l HWIO_APPS_SMMU_CB2_FSYNR0_2_APPS_ADDR A:0x1e12068
y.create.l HWIO_APPS_SMMU_CB3_FSYNR0_2_APPS_ADDR A:0x1e13068
y.create.l HWIO_APPS_SMMU_CB4_FSYNR0_2_APPS_ADDR A:0x1e14068
y.create.l HWIO_APPS_SMMU_CB5_FSYNR0_2_APPS_ADDR A:0x1e15068
y.create.l HWIO_APPS_SMMU_CB6_FSYNR0_2_APPS_ADDR A:0x1e16068
y.create.l HWIO_APPS_SMMU_CB7_FSYNR0_2_APPS_ADDR A:0x1e17068
y.create.l HWIO_APPS_SMMU_CB8_FSYNR0_2_APPS_ADDR A:0x1e18068
y.create.l HWIO_APPS_SMMU_CB9_FSYNR0_2_APPS_ADDR A:0x1e19068
y.create.l HWIO_APPS_SMMU_CB10_FSYNR0_2_APPS_ADDR A:0x1e1a068
y.create.l HWIO_APPS_SMMU_CB11_FSYNR0_2_APPS_ADDR A:0x1e1b068
y.create.l HWIO_APPS_SMMU_CB12_FSYNR0_2_APPS_ADDR A:0x1e1c068
y.create.l HWIO_APPS_SMMU_CB13_FSYNR0_2_APPS_ADDR A:0x1e1d068
y.create.l HWIO_APPS_SMMU_CB14_FSYNR0_2_APPS_ADDR A:0x1e1e068
y.create.l HWIO_APPS_SMMU_CB15_FSYNR0_2_APPS_ADDR A:0x1e1f068
y.create.l HWIO_APPS_SMMU_CB0_IPAFAR_LOW_2_APPS_ADDR A:0x1e10070
y.create.l HWIO_APPS_SMMU_CB1_IPAFAR_LOW_2_APPS_ADDR A:0x1e11070
y.create.l HWIO_APPS_SMMU_CB2_IPAFAR_LOW_2_APPS_ADDR A:0x1e12070
y.create.l HWIO_APPS_SMMU_CB3_IPAFAR_LOW_2_APPS_ADDR A:0x1e13070
y.create.l HWIO_APPS_SMMU_CB4_IPAFAR_LOW_2_APPS_ADDR A:0x1e14070
y.create.l HWIO_APPS_SMMU_CB5_IPAFAR_LOW_2_APPS_ADDR A:0x1e15070
y.create.l HWIO_APPS_SMMU_CB6_IPAFAR_LOW_2_APPS_ADDR A:0x1e16070
y.create.l HWIO_APPS_SMMU_CB7_IPAFAR_LOW_2_APPS_ADDR A:0x1e17070
y.create.l HWIO_APPS_SMMU_CB8_IPAFAR_LOW_2_APPS_ADDR A:0x1e18070
y.create.l HWIO_APPS_SMMU_CB9_IPAFAR_LOW_2_APPS_ADDR A:0x1e19070
y.create.l HWIO_APPS_SMMU_CB10_IPAFAR_LOW_2_APPS_ADDR A:0x1e1a070
y.create.l HWIO_APPS_SMMU_CB11_IPAFAR_LOW_2_APPS_ADDR A:0x1e1b070
y.create.l HWIO_APPS_SMMU_CB12_IPAFAR_LOW_2_APPS_ADDR A:0x1e1c070
y.create.l HWIO_APPS_SMMU_CB13_IPAFAR_LOW_2_APPS_ADDR A:0x1e1d070
y.create.l HWIO_APPS_SMMU_CB14_IPAFAR_LOW_2_APPS_ADDR A:0x1e1e070
y.create.l HWIO_APPS_SMMU_CB15_IPAFAR_LOW_2_APPS_ADDR A:0x1e1f070
y.create.l HWIO_APPS_SMMU_CB0_IPAFAR_HIGH_2_APPS_ADDR A:0x1e10074
y.create.l HWIO_APPS_SMMU_CB1_IPAFAR_HIGH_2_APPS_ADDR A:0x1e11074
y.create.l HWIO_APPS_SMMU_CB2_IPAFAR_HIGH_2_APPS_ADDR A:0x1e12074
y.create.l HWIO_APPS_SMMU_CB3_IPAFAR_HIGH_2_APPS_ADDR A:0x1e13074
y.create.l HWIO_APPS_SMMU_CB4_IPAFAR_HIGH_2_APPS_ADDR A:0x1e14074
y.create.l HWIO_APPS_SMMU_CB5_IPAFAR_HIGH_2_APPS_ADDR A:0x1e15074
y.create.l HWIO_APPS_SMMU_CB6_IPAFAR_HIGH_2_APPS_ADDR A:0x1e16074
y.create.l HWIO_APPS_SMMU_CB7_IPAFAR_HIGH_2_APPS_ADDR A:0x1e17074
y.create.l HWIO_APPS_SMMU_CB8_IPAFAR_HIGH_2_APPS_ADDR A:0x1e18074
y.create.l HWIO_APPS_SMMU_CB9_IPAFAR_HIGH_2_APPS_ADDR A:0x1e19074
y.create.l HWIO_APPS_SMMU_CB10_IPAFAR_HIGH_2_APPS_ADDR A:0x1e1a074
y.create.l HWIO_APPS_SMMU_CB11_IPAFAR_HIGH_2_APPS_ADDR A:0x1e1b074
y.create.l HWIO_APPS_SMMU_CB12_IPAFAR_HIGH_2_APPS_ADDR A:0x1e1c074
y.create.l HWIO_APPS_SMMU_CB13_IPAFAR_HIGH_2_APPS_ADDR A:0x1e1d074
y.create.l HWIO_APPS_SMMU_CB14_IPAFAR_HIGH_2_APPS_ADDR A:0x1e1e074
y.create.l HWIO_APPS_SMMU_CB15_IPAFAR_HIGH_2_APPS_ADDR A:0x1e1f074
y.create.l HWIO_APPS_SMMU_CB0_TLBIVA_LOW_2_APPS_ADDR A:0x1e10600
y.create.l HWIO_APPS_SMMU_CB1_TLBIVA_LOW_2_APPS_ADDR A:0x1e11600
y.create.l HWIO_APPS_SMMU_CB2_TLBIVA_LOW_2_APPS_ADDR A:0x1e12600
y.create.l HWIO_APPS_SMMU_CB3_TLBIVA_LOW_2_APPS_ADDR A:0x1e13600
y.create.l HWIO_APPS_SMMU_CB4_TLBIVA_LOW_2_APPS_ADDR A:0x1e14600
y.create.l HWIO_APPS_SMMU_CB5_TLBIVA_LOW_2_APPS_ADDR A:0x1e15600
y.create.l HWIO_APPS_SMMU_CB6_TLBIVA_LOW_2_APPS_ADDR A:0x1e16600
y.create.l HWIO_APPS_SMMU_CB7_TLBIVA_LOW_2_APPS_ADDR A:0x1e17600
y.create.l HWIO_APPS_SMMU_CB8_TLBIVA_LOW_2_APPS_ADDR A:0x1e18600
y.create.l HWIO_APPS_SMMU_CB9_TLBIVA_LOW_2_APPS_ADDR A:0x1e19600
y.create.l HWIO_APPS_SMMU_CB10_TLBIVA_LOW_2_APPS_ADDR A:0x1e1a600
y.create.l HWIO_APPS_SMMU_CB11_TLBIVA_LOW_2_APPS_ADDR A:0x1e1b600
y.create.l HWIO_APPS_SMMU_CB12_TLBIVA_LOW_2_APPS_ADDR A:0x1e1c600
y.create.l HWIO_APPS_SMMU_CB13_TLBIVA_LOW_2_APPS_ADDR A:0x1e1d600
y.create.l HWIO_APPS_SMMU_CB14_TLBIVA_LOW_2_APPS_ADDR A:0x1e1e600
y.create.l HWIO_APPS_SMMU_CB15_TLBIVA_LOW_2_APPS_ADDR A:0x1e1f600
y.create.l HWIO_APPS_SMMU_CB0_TLBIVA_HIGH_2_APPS_ADDR A:0x1e10604
y.create.l HWIO_APPS_SMMU_CB1_TLBIVA_HIGH_2_APPS_ADDR A:0x1e11604
y.create.l HWIO_APPS_SMMU_CB2_TLBIVA_HIGH_2_APPS_ADDR A:0x1e12604
y.create.l HWIO_APPS_SMMU_CB3_TLBIVA_HIGH_2_APPS_ADDR A:0x1e13604
y.create.l HWIO_APPS_SMMU_CB4_TLBIVA_HIGH_2_APPS_ADDR A:0x1e14604
y.create.l HWIO_APPS_SMMU_CB5_TLBIVA_HIGH_2_APPS_ADDR A:0x1e15604
y.create.l HWIO_APPS_SMMU_CB6_TLBIVA_HIGH_2_APPS_ADDR A:0x1e16604
y.create.l HWIO_APPS_SMMU_CB7_TLBIVA_HIGH_2_APPS_ADDR A:0x1e17604
y.create.l HWIO_APPS_SMMU_CB8_TLBIVA_HIGH_2_APPS_ADDR A:0x1e18604
y.create.l HWIO_APPS_SMMU_CB9_TLBIVA_HIGH_2_APPS_ADDR A:0x1e19604
y.create.l HWIO_APPS_SMMU_CB10_TLBIVA_HIGH_2_APPS_ADDR A:0x1e1a604
y.create.l HWIO_APPS_SMMU_CB11_TLBIVA_HIGH_2_APPS_ADDR A:0x1e1b604
y.create.l HWIO_APPS_SMMU_CB12_TLBIVA_HIGH_2_APPS_ADDR A:0x1e1c604
y.create.l HWIO_APPS_SMMU_CB13_TLBIVA_HIGH_2_APPS_ADDR A:0x1e1d604
y.create.l HWIO_APPS_SMMU_CB14_TLBIVA_HIGH_2_APPS_ADDR A:0x1e1e604
y.create.l HWIO_APPS_SMMU_CB15_TLBIVA_HIGH_2_APPS_ADDR A:0x1e1f604
y.create.l HWIO_APPS_SMMU_CB0_TLBIVAA_LOW_2_APPS_ADDR A:0x1e10608
y.create.l HWIO_APPS_SMMU_CB1_TLBIVAA_LOW_2_APPS_ADDR A:0x1e11608
y.create.l HWIO_APPS_SMMU_CB2_TLBIVAA_LOW_2_APPS_ADDR A:0x1e12608
y.create.l HWIO_APPS_SMMU_CB3_TLBIVAA_LOW_2_APPS_ADDR A:0x1e13608
y.create.l HWIO_APPS_SMMU_CB4_TLBIVAA_LOW_2_APPS_ADDR A:0x1e14608
y.create.l HWIO_APPS_SMMU_CB5_TLBIVAA_LOW_2_APPS_ADDR A:0x1e15608
y.create.l HWIO_APPS_SMMU_CB6_TLBIVAA_LOW_2_APPS_ADDR A:0x1e16608
y.create.l HWIO_APPS_SMMU_CB7_TLBIVAA_LOW_2_APPS_ADDR A:0x1e17608
y.create.l HWIO_APPS_SMMU_CB8_TLBIVAA_LOW_2_APPS_ADDR A:0x1e18608
y.create.l HWIO_APPS_SMMU_CB9_TLBIVAA_LOW_2_APPS_ADDR A:0x1e19608
y.create.l HWIO_APPS_SMMU_CB10_TLBIVAA_LOW_2_APPS_ADDR A:0x1e1a608
y.create.l HWIO_APPS_SMMU_CB11_TLBIVAA_LOW_2_APPS_ADDR A:0x1e1b608
y.create.l HWIO_APPS_SMMU_CB12_TLBIVAA_LOW_2_APPS_ADDR A:0x1e1c608
y.create.l HWIO_APPS_SMMU_CB13_TLBIVAA_LOW_2_APPS_ADDR A:0x1e1d608
y.create.l HWIO_APPS_SMMU_CB14_TLBIVAA_LOW_2_APPS_ADDR A:0x1e1e608
y.create.l HWIO_APPS_SMMU_CB15_TLBIVAA_LOW_2_APPS_ADDR A:0x1e1f608
y.create.l HWIO_APPS_SMMU_CB0_TLBIVAA_HIGH_2_APPS_ADDR A:0x1e1060c
y.create.l HWIO_APPS_SMMU_CB1_TLBIVAA_HIGH_2_APPS_ADDR A:0x1e1160c
y.create.l HWIO_APPS_SMMU_CB2_TLBIVAA_HIGH_2_APPS_ADDR A:0x1e1260c
y.create.l HWIO_APPS_SMMU_CB3_TLBIVAA_HIGH_2_APPS_ADDR A:0x1e1360c
y.create.l HWIO_APPS_SMMU_CB4_TLBIVAA_HIGH_2_APPS_ADDR A:0x1e1460c
y.create.l HWIO_APPS_SMMU_CB5_TLBIVAA_HIGH_2_APPS_ADDR A:0x1e1560c
y.create.l HWIO_APPS_SMMU_CB6_TLBIVAA_HIGH_2_APPS_ADDR A:0x1e1660c
y.create.l HWIO_APPS_SMMU_CB7_TLBIVAA_HIGH_2_APPS_ADDR A:0x1e1760c
y.create.l HWIO_APPS_SMMU_CB8_TLBIVAA_HIGH_2_APPS_ADDR A:0x1e1860c
y.create.l HWIO_APPS_SMMU_CB9_TLBIVAA_HIGH_2_APPS_ADDR A:0x1e1960c
y.create.l HWIO_APPS_SMMU_CB10_TLBIVAA_HIGH_2_APPS_ADDR A:0x1e1a60c
y.create.l HWIO_APPS_SMMU_CB11_TLBIVAA_HIGH_2_APPS_ADDR A:0x1e1b60c
y.create.l HWIO_APPS_SMMU_CB12_TLBIVAA_HIGH_2_APPS_ADDR A:0x1e1c60c
y.create.l HWIO_APPS_SMMU_CB13_TLBIVAA_HIGH_2_APPS_ADDR A:0x1e1d60c
y.create.l HWIO_APPS_SMMU_CB14_TLBIVAA_HIGH_2_APPS_ADDR A:0x1e1e60c
y.create.l HWIO_APPS_SMMU_CB15_TLBIVAA_HIGH_2_APPS_ADDR A:0x1e1f60c
y.create.l HWIO_APPS_SMMU_CB0_TLBIASID_2_APPS_ADDR A:0x1e10610
y.create.l HWIO_APPS_SMMU_CB1_TLBIASID_2_APPS_ADDR A:0x1e11610
y.create.l HWIO_APPS_SMMU_CB2_TLBIASID_2_APPS_ADDR A:0x1e12610
y.create.l HWIO_APPS_SMMU_CB3_TLBIASID_2_APPS_ADDR A:0x1e13610
y.create.l HWIO_APPS_SMMU_CB4_TLBIASID_2_APPS_ADDR A:0x1e14610
y.create.l HWIO_APPS_SMMU_CB5_TLBIASID_2_APPS_ADDR A:0x1e15610
y.create.l HWIO_APPS_SMMU_CB6_TLBIASID_2_APPS_ADDR A:0x1e16610
y.create.l HWIO_APPS_SMMU_CB7_TLBIASID_2_APPS_ADDR A:0x1e17610
y.create.l HWIO_APPS_SMMU_CB8_TLBIASID_2_APPS_ADDR A:0x1e18610
y.create.l HWIO_APPS_SMMU_CB9_TLBIASID_2_APPS_ADDR A:0x1e19610
y.create.l HWIO_APPS_SMMU_CB10_TLBIASID_2_APPS_ADDR A:0x1e1a610
y.create.l HWIO_APPS_SMMU_CB11_TLBIASID_2_APPS_ADDR A:0x1e1b610
y.create.l HWIO_APPS_SMMU_CB12_TLBIASID_2_APPS_ADDR A:0x1e1c610
y.create.l HWIO_APPS_SMMU_CB13_TLBIASID_2_APPS_ADDR A:0x1e1d610
y.create.l HWIO_APPS_SMMU_CB14_TLBIASID_2_APPS_ADDR A:0x1e1e610
y.create.l HWIO_APPS_SMMU_CB15_TLBIASID_2_APPS_ADDR A:0x1e1f610
y.create.l HWIO_APPS_SMMU_CB0_TLBIALL_2_APPS_ADDR A:0x1e10618
y.create.l HWIO_APPS_SMMU_CB1_TLBIALL_2_APPS_ADDR A:0x1e11618
y.create.l HWIO_APPS_SMMU_CB2_TLBIALL_2_APPS_ADDR A:0x1e12618
y.create.l HWIO_APPS_SMMU_CB3_TLBIALL_2_APPS_ADDR A:0x1e13618
y.create.l HWIO_APPS_SMMU_CB4_TLBIALL_2_APPS_ADDR A:0x1e14618
y.create.l HWIO_APPS_SMMU_CB5_TLBIALL_2_APPS_ADDR A:0x1e15618
y.create.l HWIO_APPS_SMMU_CB6_TLBIALL_2_APPS_ADDR A:0x1e16618
y.create.l HWIO_APPS_SMMU_CB7_TLBIALL_2_APPS_ADDR A:0x1e17618
y.create.l HWIO_APPS_SMMU_CB8_TLBIALL_2_APPS_ADDR A:0x1e18618
y.create.l HWIO_APPS_SMMU_CB9_TLBIALL_2_APPS_ADDR A:0x1e19618
y.create.l HWIO_APPS_SMMU_CB10_TLBIALL_2_APPS_ADDR A:0x1e1a618
y.create.l HWIO_APPS_SMMU_CB11_TLBIALL_2_APPS_ADDR A:0x1e1b618
y.create.l HWIO_APPS_SMMU_CB12_TLBIALL_2_APPS_ADDR A:0x1e1c618
y.create.l HWIO_APPS_SMMU_CB13_TLBIALL_2_APPS_ADDR A:0x1e1d618
y.create.l HWIO_APPS_SMMU_CB14_TLBIALL_2_APPS_ADDR A:0x1e1e618
y.create.l HWIO_APPS_SMMU_CB15_TLBIALL_2_APPS_ADDR A:0x1e1f618
y.create.l HWIO_APPS_SMMU_CB0_TLBIVAL_LOW_2_APPS_ADDR A:0x1e10620
y.create.l HWIO_APPS_SMMU_CB1_TLBIVAL_LOW_2_APPS_ADDR A:0x1e11620
y.create.l HWIO_APPS_SMMU_CB2_TLBIVAL_LOW_2_APPS_ADDR A:0x1e12620
y.create.l HWIO_APPS_SMMU_CB3_TLBIVAL_LOW_2_APPS_ADDR A:0x1e13620
y.create.l HWIO_APPS_SMMU_CB4_TLBIVAL_LOW_2_APPS_ADDR A:0x1e14620
y.create.l HWIO_APPS_SMMU_CB5_TLBIVAL_LOW_2_APPS_ADDR A:0x1e15620
y.create.l HWIO_APPS_SMMU_CB6_TLBIVAL_LOW_2_APPS_ADDR A:0x1e16620
y.create.l HWIO_APPS_SMMU_CB7_TLBIVAL_LOW_2_APPS_ADDR A:0x1e17620
y.create.l HWIO_APPS_SMMU_CB8_TLBIVAL_LOW_2_APPS_ADDR A:0x1e18620
y.create.l HWIO_APPS_SMMU_CB9_TLBIVAL_LOW_2_APPS_ADDR A:0x1e19620
y.create.l HWIO_APPS_SMMU_CB10_TLBIVAL_LOW_2_APPS_ADDR A:0x1e1a620
y.create.l HWIO_APPS_SMMU_CB11_TLBIVAL_LOW_2_APPS_ADDR A:0x1e1b620
y.create.l HWIO_APPS_SMMU_CB12_TLBIVAL_LOW_2_APPS_ADDR A:0x1e1c620
y.create.l HWIO_APPS_SMMU_CB13_TLBIVAL_LOW_2_APPS_ADDR A:0x1e1d620
y.create.l HWIO_APPS_SMMU_CB14_TLBIVAL_LOW_2_APPS_ADDR A:0x1e1e620
y.create.l HWIO_APPS_SMMU_CB15_TLBIVAL_LOW_2_APPS_ADDR A:0x1e1f620
y.create.l HWIO_APPS_SMMU_CB0_TLBIVAL_HIGH_2_APPS_ADDR A:0x1e10624
y.create.l HWIO_APPS_SMMU_CB1_TLBIVAL_HIGH_2_APPS_ADDR A:0x1e11624
y.create.l HWIO_APPS_SMMU_CB2_TLBIVAL_HIGH_2_APPS_ADDR A:0x1e12624
y.create.l HWIO_APPS_SMMU_CB3_TLBIVAL_HIGH_2_APPS_ADDR A:0x1e13624
y.create.l HWIO_APPS_SMMU_CB4_TLBIVAL_HIGH_2_APPS_ADDR A:0x1e14624
y.create.l HWIO_APPS_SMMU_CB5_TLBIVAL_HIGH_2_APPS_ADDR A:0x1e15624
y.create.l HWIO_APPS_SMMU_CB6_TLBIVAL_HIGH_2_APPS_ADDR A:0x1e16624
y.create.l HWIO_APPS_SMMU_CB7_TLBIVAL_HIGH_2_APPS_ADDR A:0x1e17624
y.create.l HWIO_APPS_SMMU_CB8_TLBIVAL_HIGH_2_APPS_ADDR A:0x1e18624
y.create.l HWIO_APPS_SMMU_CB9_TLBIVAL_HIGH_2_APPS_ADDR A:0x1e19624
y.create.l HWIO_APPS_SMMU_CB10_TLBIVAL_HIGH_2_APPS_ADDR A:0x1e1a624
y.create.l HWIO_APPS_SMMU_CB11_TLBIVAL_HIGH_2_APPS_ADDR A:0x1e1b624
y.create.l HWIO_APPS_SMMU_CB12_TLBIVAL_HIGH_2_APPS_ADDR A:0x1e1c624
y.create.l HWIO_APPS_SMMU_CB13_TLBIVAL_HIGH_2_APPS_ADDR A:0x1e1d624
y.create.l HWIO_APPS_SMMU_CB14_TLBIVAL_HIGH_2_APPS_ADDR A:0x1e1e624
y.create.l HWIO_APPS_SMMU_CB15_TLBIVAL_HIGH_2_APPS_ADDR A:0x1e1f624
y.create.l HWIO_APPS_SMMU_CB0_TLBIVAAL_LOW_2_APPS_ADDR A:0x1e10628
y.create.l HWIO_APPS_SMMU_CB1_TLBIVAAL_LOW_2_APPS_ADDR A:0x1e11628
y.create.l HWIO_APPS_SMMU_CB2_TLBIVAAL_LOW_2_APPS_ADDR A:0x1e12628
y.create.l HWIO_APPS_SMMU_CB3_TLBIVAAL_LOW_2_APPS_ADDR A:0x1e13628
y.create.l HWIO_APPS_SMMU_CB4_TLBIVAAL_LOW_2_APPS_ADDR A:0x1e14628
y.create.l HWIO_APPS_SMMU_CB5_TLBIVAAL_LOW_2_APPS_ADDR A:0x1e15628
y.create.l HWIO_APPS_SMMU_CB6_TLBIVAAL_LOW_2_APPS_ADDR A:0x1e16628
y.create.l HWIO_APPS_SMMU_CB7_TLBIVAAL_LOW_2_APPS_ADDR A:0x1e17628
y.create.l HWIO_APPS_SMMU_CB8_TLBIVAAL_LOW_2_APPS_ADDR A:0x1e18628
y.create.l HWIO_APPS_SMMU_CB9_TLBIVAAL_LOW_2_APPS_ADDR A:0x1e19628
y.create.l HWIO_APPS_SMMU_CB10_TLBIVAAL_LOW_2_APPS_ADDR A:0x1e1a628
y.create.l HWIO_APPS_SMMU_CB11_TLBIVAAL_LOW_2_APPS_ADDR A:0x1e1b628
y.create.l HWIO_APPS_SMMU_CB12_TLBIVAAL_LOW_2_APPS_ADDR A:0x1e1c628
y.create.l HWIO_APPS_SMMU_CB13_TLBIVAAL_LOW_2_APPS_ADDR A:0x1e1d628
y.create.l HWIO_APPS_SMMU_CB14_TLBIVAAL_LOW_2_APPS_ADDR A:0x1e1e628
y.create.l HWIO_APPS_SMMU_CB15_TLBIVAAL_LOW_2_APPS_ADDR A:0x1e1f628
y.create.l HWIO_APPS_SMMU_CB0_TLBIVAAL_HIGH_2_APPS_ADDR A:0x1e1062c
y.create.l HWIO_APPS_SMMU_CB1_TLBIVAAL_HIGH_2_APPS_ADDR A:0x1e1162c
y.create.l HWIO_APPS_SMMU_CB2_TLBIVAAL_HIGH_2_APPS_ADDR A:0x1e1262c
y.create.l HWIO_APPS_SMMU_CB3_TLBIVAAL_HIGH_2_APPS_ADDR A:0x1e1362c
y.create.l HWIO_APPS_SMMU_CB4_TLBIVAAL_HIGH_2_APPS_ADDR A:0x1e1462c
y.create.l HWIO_APPS_SMMU_CB5_TLBIVAAL_HIGH_2_APPS_ADDR A:0x1e1562c
y.create.l HWIO_APPS_SMMU_CB6_TLBIVAAL_HIGH_2_APPS_ADDR A:0x1e1662c
y.create.l HWIO_APPS_SMMU_CB7_TLBIVAAL_HIGH_2_APPS_ADDR A:0x1e1762c
y.create.l HWIO_APPS_SMMU_CB8_TLBIVAAL_HIGH_2_APPS_ADDR A:0x1e1862c
y.create.l HWIO_APPS_SMMU_CB9_TLBIVAAL_HIGH_2_APPS_ADDR A:0x1e1962c
y.create.l HWIO_APPS_SMMU_CB10_TLBIVAAL_HIGH_2_APPS_ADDR A:0x1e1a62c
y.create.l HWIO_APPS_SMMU_CB11_TLBIVAAL_HIGH_2_APPS_ADDR A:0x1e1b62c
y.create.l HWIO_APPS_SMMU_CB12_TLBIVAAL_HIGH_2_APPS_ADDR A:0x1e1c62c
y.create.l HWIO_APPS_SMMU_CB13_TLBIVAAL_HIGH_2_APPS_ADDR A:0x1e1d62c
y.create.l HWIO_APPS_SMMU_CB14_TLBIVAAL_HIGH_2_APPS_ADDR A:0x1e1e62c
y.create.l HWIO_APPS_SMMU_CB15_TLBIVAAL_HIGH_2_APPS_ADDR A:0x1e1f62c
y.create.l HWIO_APPS_SMMU_CB0_TLBIIPAS2_LOW_2_APPS_ADDR A:0x1e10630
y.create.l HWIO_APPS_SMMU_CB1_TLBIIPAS2_LOW_2_APPS_ADDR A:0x1e11630
y.create.l HWIO_APPS_SMMU_CB2_TLBIIPAS2_LOW_2_APPS_ADDR A:0x1e12630
y.create.l HWIO_APPS_SMMU_CB3_TLBIIPAS2_LOW_2_APPS_ADDR A:0x1e13630
y.create.l HWIO_APPS_SMMU_CB4_TLBIIPAS2_LOW_2_APPS_ADDR A:0x1e14630
y.create.l HWIO_APPS_SMMU_CB5_TLBIIPAS2_LOW_2_APPS_ADDR A:0x1e15630
y.create.l HWIO_APPS_SMMU_CB6_TLBIIPAS2_LOW_2_APPS_ADDR A:0x1e16630
y.create.l HWIO_APPS_SMMU_CB7_TLBIIPAS2_LOW_2_APPS_ADDR A:0x1e17630
y.create.l HWIO_APPS_SMMU_CB8_TLBIIPAS2_LOW_2_APPS_ADDR A:0x1e18630
y.create.l HWIO_APPS_SMMU_CB9_TLBIIPAS2_LOW_2_APPS_ADDR A:0x1e19630
y.create.l HWIO_APPS_SMMU_CB10_TLBIIPAS2_LOW_2_APPS_ADDR A:0x1e1a630
y.create.l HWIO_APPS_SMMU_CB11_TLBIIPAS2_LOW_2_APPS_ADDR A:0x1e1b630
y.create.l HWIO_APPS_SMMU_CB12_TLBIIPAS2_LOW_2_APPS_ADDR A:0x1e1c630
y.create.l HWIO_APPS_SMMU_CB13_TLBIIPAS2_LOW_2_APPS_ADDR A:0x1e1d630
y.create.l HWIO_APPS_SMMU_CB14_TLBIIPAS2_LOW_2_APPS_ADDR A:0x1e1e630
y.create.l HWIO_APPS_SMMU_CB15_TLBIIPAS2_LOW_2_APPS_ADDR A:0x1e1f630
y.create.l HWIO_APPS_SMMU_CB0_TLBIIPAS2_HIGH_2_APPS_ADDR A:0x1e10634
y.create.l HWIO_APPS_SMMU_CB1_TLBIIPAS2_HIGH_2_APPS_ADDR A:0x1e11634
y.create.l HWIO_APPS_SMMU_CB2_TLBIIPAS2_HIGH_2_APPS_ADDR A:0x1e12634
y.create.l HWIO_APPS_SMMU_CB3_TLBIIPAS2_HIGH_2_APPS_ADDR A:0x1e13634
y.create.l HWIO_APPS_SMMU_CB4_TLBIIPAS2_HIGH_2_APPS_ADDR A:0x1e14634
y.create.l HWIO_APPS_SMMU_CB5_TLBIIPAS2_HIGH_2_APPS_ADDR A:0x1e15634
y.create.l HWIO_APPS_SMMU_CB6_TLBIIPAS2_HIGH_2_APPS_ADDR A:0x1e16634
y.create.l HWIO_APPS_SMMU_CB7_TLBIIPAS2_HIGH_2_APPS_ADDR A:0x1e17634
y.create.l HWIO_APPS_SMMU_CB8_TLBIIPAS2_HIGH_2_APPS_ADDR A:0x1e18634
y.create.l HWIO_APPS_SMMU_CB9_TLBIIPAS2_HIGH_2_APPS_ADDR A:0x1e19634
y.create.l HWIO_APPS_SMMU_CB10_TLBIIPAS2_HIGH_2_APPS_ADDR A:0x1e1a634
y.create.l HWIO_APPS_SMMU_CB11_TLBIIPAS2_HIGH_2_APPS_ADDR A:0x1e1b634
y.create.l HWIO_APPS_SMMU_CB12_TLBIIPAS2_HIGH_2_APPS_ADDR A:0x1e1c634
y.create.l HWIO_APPS_SMMU_CB13_TLBIIPAS2_HIGH_2_APPS_ADDR A:0x1e1d634
y.create.l HWIO_APPS_SMMU_CB14_TLBIIPAS2_HIGH_2_APPS_ADDR A:0x1e1e634
y.create.l HWIO_APPS_SMMU_CB15_TLBIIPAS2_HIGH_2_APPS_ADDR A:0x1e1f634
y.create.l HWIO_APPS_SMMU_CB0_TLBIIPAS2L_LOW_2_APPS_ADDR A:0x1e10638
y.create.l HWIO_APPS_SMMU_CB1_TLBIIPAS2L_LOW_2_APPS_ADDR A:0x1e11638
y.create.l HWIO_APPS_SMMU_CB2_TLBIIPAS2L_LOW_2_APPS_ADDR A:0x1e12638
y.create.l HWIO_APPS_SMMU_CB3_TLBIIPAS2L_LOW_2_APPS_ADDR A:0x1e13638
y.create.l HWIO_APPS_SMMU_CB4_TLBIIPAS2L_LOW_2_APPS_ADDR A:0x1e14638
y.create.l HWIO_APPS_SMMU_CB5_TLBIIPAS2L_LOW_2_APPS_ADDR A:0x1e15638
y.create.l HWIO_APPS_SMMU_CB6_TLBIIPAS2L_LOW_2_APPS_ADDR A:0x1e16638
y.create.l HWIO_APPS_SMMU_CB7_TLBIIPAS2L_LOW_2_APPS_ADDR A:0x1e17638
y.create.l HWIO_APPS_SMMU_CB8_TLBIIPAS2L_LOW_2_APPS_ADDR A:0x1e18638
y.create.l HWIO_APPS_SMMU_CB9_TLBIIPAS2L_LOW_2_APPS_ADDR A:0x1e19638
y.create.l HWIO_APPS_SMMU_CB10_TLBIIPAS2L_LOW_2_APPS_ADDR A:0x1e1a638
y.create.l HWIO_APPS_SMMU_CB11_TLBIIPAS2L_LOW_2_APPS_ADDR A:0x1e1b638
y.create.l HWIO_APPS_SMMU_CB12_TLBIIPAS2L_LOW_2_APPS_ADDR A:0x1e1c638
y.create.l HWIO_APPS_SMMU_CB13_TLBIIPAS2L_LOW_2_APPS_ADDR A:0x1e1d638
y.create.l HWIO_APPS_SMMU_CB14_TLBIIPAS2L_LOW_2_APPS_ADDR A:0x1e1e638
y.create.l HWIO_APPS_SMMU_CB15_TLBIIPAS2L_LOW_2_APPS_ADDR A:0x1e1f638
y.create.l HWIO_APPS_SMMU_CB0_TLBIIPAS2L_HIGH_2_APPS_ADDR A:0x1e1063c
y.create.l HWIO_APPS_SMMU_CB1_TLBIIPAS2L_HIGH_2_APPS_ADDR A:0x1e1163c
y.create.l HWIO_APPS_SMMU_CB2_TLBIIPAS2L_HIGH_2_APPS_ADDR A:0x1e1263c
y.create.l HWIO_APPS_SMMU_CB3_TLBIIPAS2L_HIGH_2_APPS_ADDR A:0x1e1363c
y.create.l HWIO_APPS_SMMU_CB4_TLBIIPAS2L_HIGH_2_APPS_ADDR A:0x1e1463c
y.create.l HWIO_APPS_SMMU_CB5_TLBIIPAS2L_HIGH_2_APPS_ADDR A:0x1e1563c
y.create.l HWIO_APPS_SMMU_CB6_TLBIIPAS2L_HIGH_2_APPS_ADDR A:0x1e1663c
y.create.l HWIO_APPS_SMMU_CB7_TLBIIPAS2L_HIGH_2_APPS_ADDR A:0x1e1763c
y.create.l HWIO_APPS_SMMU_CB8_TLBIIPAS2L_HIGH_2_APPS_ADDR A:0x1e1863c
y.create.l HWIO_APPS_SMMU_CB9_TLBIIPAS2L_HIGH_2_APPS_ADDR A:0x1e1963c
y.create.l HWIO_APPS_SMMU_CB10_TLBIIPAS2L_HIGH_2_APPS_ADDR A:0x1e1a63c
y.create.l HWIO_APPS_SMMU_CB11_TLBIIPAS2L_HIGH_2_APPS_ADDR A:0x1e1b63c
y.create.l HWIO_APPS_SMMU_CB12_TLBIIPAS2L_HIGH_2_APPS_ADDR A:0x1e1c63c
y.create.l HWIO_APPS_SMMU_CB13_TLBIIPAS2L_HIGH_2_APPS_ADDR A:0x1e1d63c
y.create.l HWIO_APPS_SMMU_CB14_TLBIIPAS2L_HIGH_2_APPS_ADDR A:0x1e1e63c
y.create.l HWIO_APPS_SMMU_CB15_TLBIIPAS2L_HIGH_2_APPS_ADDR A:0x1e1f63c
y.create.l HWIO_APPS_SMMU_CB0_TLBSYNC_2_APPS_ADDR A:0x1e107f0
y.create.l HWIO_APPS_SMMU_CB1_TLBSYNC_2_APPS_ADDR A:0x1e117f0
y.create.l HWIO_APPS_SMMU_CB2_TLBSYNC_2_APPS_ADDR A:0x1e127f0
y.create.l HWIO_APPS_SMMU_CB3_TLBSYNC_2_APPS_ADDR A:0x1e137f0
y.create.l HWIO_APPS_SMMU_CB4_TLBSYNC_2_APPS_ADDR A:0x1e147f0
y.create.l HWIO_APPS_SMMU_CB5_TLBSYNC_2_APPS_ADDR A:0x1e157f0
y.create.l HWIO_APPS_SMMU_CB6_TLBSYNC_2_APPS_ADDR A:0x1e167f0
y.create.l HWIO_APPS_SMMU_CB7_TLBSYNC_2_APPS_ADDR A:0x1e177f0
y.create.l HWIO_APPS_SMMU_CB8_TLBSYNC_2_APPS_ADDR A:0x1e187f0
y.create.l HWIO_APPS_SMMU_CB9_TLBSYNC_2_APPS_ADDR A:0x1e197f0
y.create.l HWIO_APPS_SMMU_CB10_TLBSYNC_2_APPS_ADDR A:0x1e1a7f0
y.create.l HWIO_APPS_SMMU_CB11_TLBSYNC_2_APPS_ADDR A:0x1e1b7f0
y.create.l HWIO_APPS_SMMU_CB12_TLBSYNC_2_APPS_ADDR A:0x1e1c7f0
y.create.l HWIO_APPS_SMMU_CB13_TLBSYNC_2_APPS_ADDR A:0x1e1d7f0
y.create.l HWIO_APPS_SMMU_CB14_TLBSYNC_2_APPS_ADDR A:0x1e1e7f0
y.create.l HWIO_APPS_SMMU_CB15_TLBSYNC_2_APPS_ADDR A:0x1e1f7f0
y.create.l HWIO_APPS_SMMU_CB0_TLBSTATUS_2_APPS_ADDR A:0x1e107f4
y.create.l HWIO_APPS_SMMU_CB1_TLBSTATUS_2_APPS_ADDR A:0x1e117f4
y.create.l HWIO_APPS_SMMU_CB2_TLBSTATUS_2_APPS_ADDR A:0x1e127f4
y.create.l HWIO_APPS_SMMU_CB3_TLBSTATUS_2_APPS_ADDR A:0x1e137f4
y.create.l HWIO_APPS_SMMU_CB4_TLBSTATUS_2_APPS_ADDR A:0x1e147f4
y.create.l HWIO_APPS_SMMU_CB5_TLBSTATUS_2_APPS_ADDR A:0x1e157f4
y.create.l HWIO_APPS_SMMU_CB6_TLBSTATUS_2_APPS_ADDR A:0x1e167f4
y.create.l HWIO_APPS_SMMU_CB7_TLBSTATUS_2_APPS_ADDR A:0x1e177f4
y.create.l HWIO_APPS_SMMU_CB8_TLBSTATUS_2_APPS_ADDR A:0x1e187f4
y.create.l HWIO_APPS_SMMU_CB9_TLBSTATUS_2_APPS_ADDR A:0x1e197f4
y.create.l HWIO_APPS_SMMU_CB10_TLBSTATUS_2_APPS_ADDR A:0x1e1a7f4
y.create.l HWIO_APPS_SMMU_CB11_TLBSTATUS_2_APPS_ADDR A:0x1e1b7f4
y.create.l HWIO_APPS_SMMU_CB12_TLBSTATUS_2_APPS_ADDR A:0x1e1c7f4
y.create.l HWIO_APPS_SMMU_CB13_TLBSTATUS_2_APPS_ADDR A:0x1e1d7f4
y.create.l HWIO_APPS_SMMU_CB14_TLBSTATUS_2_APPS_ADDR A:0x1e1e7f4
y.create.l HWIO_APPS_SMMU_CB15_TLBSTATUS_2_APPS_ADDR A:0x1e1f7f4
y.create.l HWIO_APPS_SMMU_CB0_PMEVCNTR0_2_APPS_ADDR A:0x1e10e00
y.create.l HWIO_APPS_SMMU_CB1_PMEVCNTR0_2_APPS_ADDR A:0x1e11e00
y.create.l HWIO_APPS_SMMU_CB2_PMEVCNTR0_2_APPS_ADDR A:0x1e12e00
y.create.l HWIO_APPS_SMMU_CB3_PMEVCNTR0_2_APPS_ADDR A:0x1e13e00
y.create.l HWIO_APPS_SMMU_CB4_PMEVCNTR0_2_APPS_ADDR A:0x1e14e00
y.create.l HWIO_APPS_SMMU_CB5_PMEVCNTR0_2_APPS_ADDR A:0x1e15e00
y.create.l HWIO_APPS_SMMU_CB6_PMEVCNTR0_2_APPS_ADDR A:0x1e16e00
y.create.l HWIO_APPS_SMMU_CB7_PMEVCNTR0_2_APPS_ADDR A:0x1e17e00
y.create.l HWIO_APPS_SMMU_CB8_PMEVCNTR0_2_APPS_ADDR A:0x1e18e00
y.create.l HWIO_APPS_SMMU_CB9_PMEVCNTR0_2_APPS_ADDR A:0x1e19e00
y.create.l HWIO_APPS_SMMU_CB10_PMEVCNTR0_2_APPS_ADDR A:0x1e1ae00
y.create.l HWIO_APPS_SMMU_CB11_PMEVCNTR0_2_APPS_ADDR A:0x1e1be00
y.create.l HWIO_APPS_SMMU_CB12_PMEVCNTR0_2_APPS_ADDR A:0x1e1ce00
y.create.l HWIO_APPS_SMMU_CB13_PMEVCNTR0_2_APPS_ADDR A:0x1e1de00
y.create.l HWIO_APPS_SMMU_CB14_PMEVCNTR0_2_APPS_ADDR A:0x1e1ee00
y.create.l HWIO_APPS_SMMU_CB15_PMEVCNTR0_2_APPS_ADDR A:0x1e1fe00
y.create.l HWIO_APPS_SMMU_CB0_PMEVCNTR1_2_APPS_ADDR A:0x1e10e04
y.create.l HWIO_APPS_SMMU_CB1_PMEVCNTR1_2_APPS_ADDR A:0x1e11e04
y.create.l HWIO_APPS_SMMU_CB2_PMEVCNTR1_2_APPS_ADDR A:0x1e12e04
y.create.l HWIO_APPS_SMMU_CB3_PMEVCNTR1_2_APPS_ADDR A:0x1e13e04
y.create.l HWIO_APPS_SMMU_CB4_PMEVCNTR1_2_APPS_ADDR A:0x1e14e04
y.create.l HWIO_APPS_SMMU_CB5_PMEVCNTR1_2_APPS_ADDR A:0x1e15e04
y.create.l HWIO_APPS_SMMU_CB6_PMEVCNTR1_2_APPS_ADDR A:0x1e16e04
y.create.l HWIO_APPS_SMMU_CB7_PMEVCNTR1_2_APPS_ADDR A:0x1e17e04
y.create.l HWIO_APPS_SMMU_CB8_PMEVCNTR1_2_APPS_ADDR A:0x1e18e04
y.create.l HWIO_APPS_SMMU_CB9_PMEVCNTR1_2_APPS_ADDR A:0x1e19e04
y.create.l HWIO_APPS_SMMU_CB10_PMEVCNTR1_2_APPS_ADDR A:0x1e1ae04
y.create.l HWIO_APPS_SMMU_CB11_PMEVCNTR1_2_APPS_ADDR A:0x1e1be04
y.create.l HWIO_APPS_SMMU_CB12_PMEVCNTR1_2_APPS_ADDR A:0x1e1ce04
y.create.l HWIO_APPS_SMMU_CB13_PMEVCNTR1_2_APPS_ADDR A:0x1e1de04
y.create.l HWIO_APPS_SMMU_CB14_PMEVCNTR1_2_APPS_ADDR A:0x1e1ee04
y.create.l HWIO_APPS_SMMU_CB15_PMEVCNTR1_2_APPS_ADDR A:0x1e1fe04
y.create.l HWIO_APPS_SMMU_CB0_PMEVCNTR2_2_APPS_ADDR A:0x1e10e08
y.create.l HWIO_APPS_SMMU_CB1_PMEVCNTR2_2_APPS_ADDR A:0x1e11e08
y.create.l HWIO_APPS_SMMU_CB2_PMEVCNTR2_2_APPS_ADDR A:0x1e12e08
y.create.l HWIO_APPS_SMMU_CB3_PMEVCNTR2_2_APPS_ADDR A:0x1e13e08
y.create.l HWIO_APPS_SMMU_CB4_PMEVCNTR2_2_APPS_ADDR A:0x1e14e08
y.create.l HWIO_APPS_SMMU_CB5_PMEVCNTR2_2_APPS_ADDR A:0x1e15e08
y.create.l HWIO_APPS_SMMU_CB6_PMEVCNTR2_2_APPS_ADDR A:0x1e16e08
y.create.l HWIO_APPS_SMMU_CB7_PMEVCNTR2_2_APPS_ADDR A:0x1e17e08
y.create.l HWIO_APPS_SMMU_CB8_PMEVCNTR2_2_APPS_ADDR A:0x1e18e08
y.create.l HWIO_APPS_SMMU_CB9_PMEVCNTR2_2_APPS_ADDR A:0x1e19e08
y.create.l HWIO_APPS_SMMU_CB10_PMEVCNTR2_2_APPS_ADDR A:0x1e1ae08
y.create.l HWIO_APPS_SMMU_CB11_PMEVCNTR2_2_APPS_ADDR A:0x1e1be08
y.create.l HWIO_APPS_SMMU_CB12_PMEVCNTR2_2_APPS_ADDR A:0x1e1ce08
y.create.l HWIO_APPS_SMMU_CB13_PMEVCNTR2_2_APPS_ADDR A:0x1e1de08
y.create.l HWIO_APPS_SMMU_CB14_PMEVCNTR2_2_APPS_ADDR A:0x1e1ee08
y.create.l HWIO_APPS_SMMU_CB15_PMEVCNTR2_2_APPS_ADDR A:0x1e1fe08
y.create.l HWIO_APPS_SMMU_CB0_PMEVCNTR3_2_APPS_ADDR A:0x1e10e0c
y.create.l HWIO_APPS_SMMU_CB1_PMEVCNTR3_2_APPS_ADDR A:0x1e11e0c
y.create.l HWIO_APPS_SMMU_CB2_PMEVCNTR3_2_APPS_ADDR A:0x1e12e0c
y.create.l HWIO_APPS_SMMU_CB3_PMEVCNTR3_2_APPS_ADDR A:0x1e13e0c
y.create.l HWIO_APPS_SMMU_CB4_PMEVCNTR3_2_APPS_ADDR A:0x1e14e0c
y.create.l HWIO_APPS_SMMU_CB5_PMEVCNTR3_2_APPS_ADDR A:0x1e15e0c
y.create.l HWIO_APPS_SMMU_CB6_PMEVCNTR3_2_APPS_ADDR A:0x1e16e0c
y.create.l HWIO_APPS_SMMU_CB7_PMEVCNTR3_2_APPS_ADDR A:0x1e17e0c
y.create.l HWIO_APPS_SMMU_CB8_PMEVCNTR3_2_APPS_ADDR A:0x1e18e0c
y.create.l HWIO_APPS_SMMU_CB9_PMEVCNTR3_2_APPS_ADDR A:0x1e19e0c
y.create.l HWIO_APPS_SMMU_CB10_PMEVCNTR3_2_APPS_ADDR A:0x1e1ae0c
y.create.l HWIO_APPS_SMMU_CB11_PMEVCNTR3_2_APPS_ADDR A:0x1e1be0c
y.create.l HWIO_APPS_SMMU_CB12_PMEVCNTR3_2_APPS_ADDR A:0x1e1ce0c
y.create.l HWIO_APPS_SMMU_CB13_PMEVCNTR3_2_APPS_ADDR A:0x1e1de0c
y.create.l HWIO_APPS_SMMU_CB14_PMEVCNTR3_2_APPS_ADDR A:0x1e1ee0c
y.create.l HWIO_APPS_SMMU_CB15_PMEVCNTR3_2_APPS_ADDR A:0x1e1fe0c
y.create.l HWIO_APPS_SMMU_CB0_PMEVTYPER0_2_APPS_ADDR A:0x1e10e80
y.create.l HWIO_APPS_SMMU_CB1_PMEVTYPER0_2_APPS_ADDR A:0x1e11e80
y.create.l HWIO_APPS_SMMU_CB2_PMEVTYPER0_2_APPS_ADDR A:0x1e12e80
y.create.l HWIO_APPS_SMMU_CB3_PMEVTYPER0_2_APPS_ADDR A:0x1e13e80
y.create.l HWIO_APPS_SMMU_CB4_PMEVTYPER0_2_APPS_ADDR A:0x1e14e80
y.create.l HWIO_APPS_SMMU_CB5_PMEVTYPER0_2_APPS_ADDR A:0x1e15e80
y.create.l HWIO_APPS_SMMU_CB6_PMEVTYPER0_2_APPS_ADDR A:0x1e16e80
y.create.l HWIO_APPS_SMMU_CB7_PMEVTYPER0_2_APPS_ADDR A:0x1e17e80
y.create.l HWIO_APPS_SMMU_CB8_PMEVTYPER0_2_APPS_ADDR A:0x1e18e80
y.create.l HWIO_APPS_SMMU_CB9_PMEVTYPER0_2_APPS_ADDR A:0x1e19e80
y.create.l HWIO_APPS_SMMU_CB10_PMEVTYPER0_2_APPS_ADDR A:0x1e1ae80
y.create.l HWIO_APPS_SMMU_CB11_PMEVTYPER0_2_APPS_ADDR A:0x1e1be80
y.create.l HWIO_APPS_SMMU_CB12_PMEVTYPER0_2_APPS_ADDR A:0x1e1ce80
y.create.l HWIO_APPS_SMMU_CB13_PMEVTYPER0_2_APPS_ADDR A:0x1e1de80
y.create.l HWIO_APPS_SMMU_CB14_PMEVTYPER0_2_APPS_ADDR A:0x1e1ee80
y.create.l HWIO_APPS_SMMU_CB15_PMEVTYPER0_2_APPS_ADDR A:0x1e1fe80
y.create.l HWIO_APPS_SMMU_CB0_PMEVTYPER1_2_APPS_ADDR A:0x1e10e84
y.create.l HWIO_APPS_SMMU_CB1_PMEVTYPER1_2_APPS_ADDR A:0x1e11e84
y.create.l HWIO_APPS_SMMU_CB2_PMEVTYPER1_2_APPS_ADDR A:0x1e12e84
y.create.l HWIO_APPS_SMMU_CB3_PMEVTYPER1_2_APPS_ADDR A:0x1e13e84
y.create.l HWIO_APPS_SMMU_CB4_PMEVTYPER1_2_APPS_ADDR A:0x1e14e84
y.create.l HWIO_APPS_SMMU_CB5_PMEVTYPER1_2_APPS_ADDR A:0x1e15e84
y.create.l HWIO_APPS_SMMU_CB6_PMEVTYPER1_2_APPS_ADDR A:0x1e16e84
y.create.l HWIO_APPS_SMMU_CB7_PMEVTYPER1_2_APPS_ADDR A:0x1e17e84
y.create.l HWIO_APPS_SMMU_CB8_PMEVTYPER1_2_APPS_ADDR A:0x1e18e84
y.create.l HWIO_APPS_SMMU_CB9_PMEVTYPER1_2_APPS_ADDR A:0x1e19e84
y.create.l HWIO_APPS_SMMU_CB10_PMEVTYPER1_2_APPS_ADDR A:0x1e1ae84
y.create.l HWIO_APPS_SMMU_CB11_PMEVTYPER1_2_APPS_ADDR A:0x1e1be84
y.create.l HWIO_APPS_SMMU_CB12_PMEVTYPER1_2_APPS_ADDR A:0x1e1ce84
y.create.l HWIO_APPS_SMMU_CB13_PMEVTYPER1_2_APPS_ADDR A:0x1e1de84
y.create.l HWIO_APPS_SMMU_CB14_PMEVTYPER1_2_APPS_ADDR A:0x1e1ee84
y.create.l HWIO_APPS_SMMU_CB15_PMEVTYPER1_2_APPS_ADDR A:0x1e1fe84
y.create.l HWIO_APPS_SMMU_CB0_PMEVTYPER2_2_APPS_ADDR A:0x1e10e88
y.create.l HWIO_APPS_SMMU_CB1_PMEVTYPER2_2_APPS_ADDR A:0x1e11e88
y.create.l HWIO_APPS_SMMU_CB2_PMEVTYPER2_2_APPS_ADDR A:0x1e12e88
y.create.l HWIO_APPS_SMMU_CB3_PMEVTYPER2_2_APPS_ADDR A:0x1e13e88
y.create.l HWIO_APPS_SMMU_CB4_PMEVTYPER2_2_APPS_ADDR A:0x1e14e88
y.create.l HWIO_APPS_SMMU_CB5_PMEVTYPER2_2_APPS_ADDR A:0x1e15e88
y.create.l HWIO_APPS_SMMU_CB6_PMEVTYPER2_2_APPS_ADDR A:0x1e16e88
y.create.l HWIO_APPS_SMMU_CB7_PMEVTYPER2_2_APPS_ADDR A:0x1e17e88
y.create.l HWIO_APPS_SMMU_CB8_PMEVTYPER2_2_APPS_ADDR A:0x1e18e88
y.create.l HWIO_APPS_SMMU_CB9_PMEVTYPER2_2_APPS_ADDR A:0x1e19e88
y.create.l HWIO_APPS_SMMU_CB10_PMEVTYPER2_2_APPS_ADDR A:0x1e1ae88
y.create.l HWIO_APPS_SMMU_CB11_PMEVTYPER2_2_APPS_ADDR A:0x1e1be88
y.create.l HWIO_APPS_SMMU_CB12_PMEVTYPER2_2_APPS_ADDR A:0x1e1ce88
y.create.l HWIO_APPS_SMMU_CB13_PMEVTYPER2_2_APPS_ADDR A:0x1e1de88
y.create.l HWIO_APPS_SMMU_CB14_PMEVTYPER2_2_APPS_ADDR A:0x1e1ee88
y.create.l HWIO_APPS_SMMU_CB15_PMEVTYPER2_2_APPS_ADDR A:0x1e1fe88
y.create.l HWIO_APPS_SMMU_CB0_PMEVTYPER3_2_APPS_ADDR A:0x1e10e8c
y.create.l HWIO_APPS_SMMU_CB1_PMEVTYPER3_2_APPS_ADDR A:0x1e11e8c
y.create.l HWIO_APPS_SMMU_CB2_PMEVTYPER3_2_APPS_ADDR A:0x1e12e8c
y.create.l HWIO_APPS_SMMU_CB3_PMEVTYPER3_2_APPS_ADDR A:0x1e13e8c
y.create.l HWIO_APPS_SMMU_CB4_PMEVTYPER3_2_APPS_ADDR A:0x1e14e8c
y.create.l HWIO_APPS_SMMU_CB5_PMEVTYPER3_2_APPS_ADDR A:0x1e15e8c
y.create.l HWIO_APPS_SMMU_CB6_PMEVTYPER3_2_APPS_ADDR A:0x1e16e8c
y.create.l HWIO_APPS_SMMU_CB7_PMEVTYPER3_2_APPS_ADDR A:0x1e17e8c
y.create.l HWIO_APPS_SMMU_CB8_PMEVTYPER3_2_APPS_ADDR A:0x1e18e8c
y.create.l HWIO_APPS_SMMU_CB9_PMEVTYPER3_2_APPS_ADDR A:0x1e19e8c
y.create.l HWIO_APPS_SMMU_CB10_PMEVTYPER3_2_APPS_ADDR A:0x1e1ae8c
y.create.l HWIO_APPS_SMMU_CB11_PMEVTYPER3_2_APPS_ADDR A:0x1e1be8c
y.create.l HWIO_APPS_SMMU_CB12_PMEVTYPER3_2_APPS_ADDR A:0x1e1ce8c
y.create.l HWIO_APPS_SMMU_CB13_PMEVTYPER3_2_APPS_ADDR A:0x1e1de8c
y.create.l HWIO_APPS_SMMU_CB14_PMEVTYPER3_2_APPS_ADDR A:0x1e1ee8c
y.create.l HWIO_APPS_SMMU_CB15_PMEVTYPER3_2_APPS_ADDR A:0x1e1fe8c
y.create.l HWIO_APPS_SMMU_CB0_PMCFGR_2_APPS_ADDR A:0x1e10f00
y.create.l HWIO_APPS_SMMU_CB1_PMCFGR_2_APPS_ADDR A:0x1e11f00
y.create.l HWIO_APPS_SMMU_CB2_PMCFGR_2_APPS_ADDR A:0x1e12f00
y.create.l HWIO_APPS_SMMU_CB3_PMCFGR_2_APPS_ADDR A:0x1e13f00
y.create.l HWIO_APPS_SMMU_CB4_PMCFGR_2_APPS_ADDR A:0x1e14f00
y.create.l HWIO_APPS_SMMU_CB5_PMCFGR_2_APPS_ADDR A:0x1e15f00
y.create.l HWIO_APPS_SMMU_CB6_PMCFGR_2_APPS_ADDR A:0x1e16f00
y.create.l HWIO_APPS_SMMU_CB7_PMCFGR_2_APPS_ADDR A:0x1e17f00
y.create.l HWIO_APPS_SMMU_CB8_PMCFGR_2_APPS_ADDR A:0x1e18f00
y.create.l HWIO_APPS_SMMU_CB9_PMCFGR_2_APPS_ADDR A:0x1e19f00
y.create.l HWIO_APPS_SMMU_CB10_PMCFGR_2_APPS_ADDR A:0x1e1af00
y.create.l HWIO_APPS_SMMU_CB11_PMCFGR_2_APPS_ADDR A:0x1e1bf00
y.create.l HWIO_APPS_SMMU_CB12_PMCFGR_2_APPS_ADDR A:0x1e1cf00
y.create.l HWIO_APPS_SMMU_CB13_PMCFGR_2_APPS_ADDR A:0x1e1df00
y.create.l HWIO_APPS_SMMU_CB14_PMCFGR_2_APPS_ADDR A:0x1e1ef00
y.create.l HWIO_APPS_SMMU_CB15_PMCFGR_2_APPS_ADDR A:0x1e1ff00
y.create.l HWIO_APPS_SMMU_CB0_PMCR_2_APPS_ADDR A:0x1e10f04
y.create.l HWIO_APPS_SMMU_CB1_PMCR_2_APPS_ADDR A:0x1e11f04
y.create.l HWIO_APPS_SMMU_CB2_PMCR_2_APPS_ADDR A:0x1e12f04
y.create.l HWIO_APPS_SMMU_CB3_PMCR_2_APPS_ADDR A:0x1e13f04
y.create.l HWIO_APPS_SMMU_CB4_PMCR_2_APPS_ADDR A:0x1e14f04
y.create.l HWIO_APPS_SMMU_CB5_PMCR_2_APPS_ADDR A:0x1e15f04
y.create.l HWIO_APPS_SMMU_CB6_PMCR_2_APPS_ADDR A:0x1e16f04
y.create.l HWIO_APPS_SMMU_CB7_PMCR_2_APPS_ADDR A:0x1e17f04
y.create.l HWIO_APPS_SMMU_CB8_PMCR_2_APPS_ADDR A:0x1e18f04
y.create.l HWIO_APPS_SMMU_CB9_PMCR_2_APPS_ADDR A:0x1e19f04
y.create.l HWIO_APPS_SMMU_CB10_PMCR_2_APPS_ADDR A:0x1e1af04
y.create.l HWIO_APPS_SMMU_CB11_PMCR_2_APPS_ADDR A:0x1e1bf04
y.create.l HWIO_APPS_SMMU_CB12_PMCR_2_APPS_ADDR A:0x1e1cf04
y.create.l HWIO_APPS_SMMU_CB13_PMCR_2_APPS_ADDR A:0x1e1df04
y.create.l HWIO_APPS_SMMU_CB14_PMCR_2_APPS_ADDR A:0x1e1ef04
y.create.l HWIO_APPS_SMMU_CB15_PMCR_2_APPS_ADDR A:0x1e1ff04
y.create.l HWIO_APPS_SMMU_CB0_PMCEID_2_APPS_ADDR A:0x1e10f20
y.create.l HWIO_APPS_SMMU_CB1_PMCEID_2_APPS_ADDR A:0x1e11f20
y.create.l HWIO_APPS_SMMU_CB2_PMCEID_2_APPS_ADDR A:0x1e12f20
y.create.l HWIO_APPS_SMMU_CB3_PMCEID_2_APPS_ADDR A:0x1e13f20
y.create.l HWIO_APPS_SMMU_CB4_PMCEID_2_APPS_ADDR A:0x1e14f20
y.create.l HWIO_APPS_SMMU_CB5_PMCEID_2_APPS_ADDR A:0x1e15f20
y.create.l HWIO_APPS_SMMU_CB6_PMCEID_2_APPS_ADDR A:0x1e16f20
y.create.l HWIO_APPS_SMMU_CB7_PMCEID_2_APPS_ADDR A:0x1e17f20
y.create.l HWIO_APPS_SMMU_CB8_PMCEID_2_APPS_ADDR A:0x1e18f20
y.create.l HWIO_APPS_SMMU_CB9_PMCEID_2_APPS_ADDR A:0x1e19f20
y.create.l HWIO_APPS_SMMU_CB10_PMCEID_2_APPS_ADDR A:0x1e1af20
y.create.l HWIO_APPS_SMMU_CB11_PMCEID_2_APPS_ADDR A:0x1e1bf20
y.create.l HWIO_APPS_SMMU_CB12_PMCEID_2_APPS_ADDR A:0x1e1cf20
y.create.l HWIO_APPS_SMMU_CB13_PMCEID_2_APPS_ADDR A:0x1e1df20
y.create.l HWIO_APPS_SMMU_CB14_PMCEID_2_APPS_ADDR A:0x1e1ef20
y.create.l HWIO_APPS_SMMU_CB15_PMCEID_2_APPS_ADDR A:0x1e1ff20
y.create.l HWIO_APPS_SMMU_CB0_PMCNTENSE_2_APPS_ADDR A:0x1e10f40
y.create.l HWIO_APPS_SMMU_CB1_PMCNTENSE_2_APPS_ADDR A:0x1e11f40
y.create.l HWIO_APPS_SMMU_CB2_PMCNTENSE_2_APPS_ADDR A:0x1e12f40
y.create.l HWIO_APPS_SMMU_CB3_PMCNTENSE_2_APPS_ADDR A:0x1e13f40
y.create.l HWIO_APPS_SMMU_CB4_PMCNTENSE_2_APPS_ADDR A:0x1e14f40
y.create.l HWIO_APPS_SMMU_CB5_PMCNTENSE_2_APPS_ADDR A:0x1e15f40
y.create.l HWIO_APPS_SMMU_CB6_PMCNTENSE_2_APPS_ADDR A:0x1e16f40
y.create.l HWIO_APPS_SMMU_CB7_PMCNTENSE_2_APPS_ADDR A:0x1e17f40
y.create.l HWIO_APPS_SMMU_CB8_PMCNTENSE_2_APPS_ADDR A:0x1e18f40
y.create.l HWIO_APPS_SMMU_CB9_PMCNTENSE_2_APPS_ADDR A:0x1e19f40
y.create.l HWIO_APPS_SMMU_CB10_PMCNTENSE_2_APPS_ADDR A:0x1e1af40
y.create.l HWIO_APPS_SMMU_CB11_PMCNTENSE_2_APPS_ADDR A:0x1e1bf40
y.create.l HWIO_APPS_SMMU_CB12_PMCNTENSE_2_APPS_ADDR A:0x1e1cf40
y.create.l HWIO_APPS_SMMU_CB13_PMCNTENSE_2_APPS_ADDR A:0x1e1df40
y.create.l HWIO_APPS_SMMU_CB14_PMCNTENSE_2_APPS_ADDR A:0x1e1ef40
y.create.l HWIO_APPS_SMMU_CB15_PMCNTENSE_2_APPS_ADDR A:0x1e1ff40
y.create.l HWIO_APPS_SMMU_CB0_PMCNTENCLR_2_APPS_ADDR A:0x1e10f44
y.create.l HWIO_APPS_SMMU_CB1_PMCNTENCLR_2_APPS_ADDR A:0x1e11f44
y.create.l HWIO_APPS_SMMU_CB2_PMCNTENCLR_2_APPS_ADDR A:0x1e12f44
y.create.l HWIO_APPS_SMMU_CB3_PMCNTENCLR_2_APPS_ADDR A:0x1e13f44
y.create.l HWIO_APPS_SMMU_CB4_PMCNTENCLR_2_APPS_ADDR A:0x1e14f44
y.create.l HWIO_APPS_SMMU_CB5_PMCNTENCLR_2_APPS_ADDR A:0x1e15f44
y.create.l HWIO_APPS_SMMU_CB6_PMCNTENCLR_2_APPS_ADDR A:0x1e16f44
y.create.l HWIO_APPS_SMMU_CB7_PMCNTENCLR_2_APPS_ADDR A:0x1e17f44
y.create.l HWIO_APPS_SMMU_CB8_PMCNTENCLR_2_APPS_ADDR A:0x1e18f44
y.create.l HWIO_APPS_SMMU_CB9_PMCNTENCLR_2_APPS_ADDR A:0x1e19f44
y.create.l HWIO_APPS_SMMU_CB10_PMCNTENCLR_2_APPS_ADDR A:0x1e1af44
y.create.l HWIO_APPS_SMMU_CB11_PMCNTENCLR_2_APPS_ADDR A:0x1e1bf44
y.create.l HWIO_APPS_SMMU_CB12_PMCNTENCLR_2_APPS_ADDR A:0x1e1cf44
y.create.l HWIO_APPS_SMMU_CB13_PMCNTENCLR_2_APPS_ADDR A:0x1e1df44
y.create.l HWIO_APPS_SMMU_CB14_PMCNTENCLR_2_APPS_ADDR A:0x1e1ef44
y.create.l HWIO_APPS_SMMU_CB15_PMCNTENCLR_2_APPS_ADDR A:0x1e1ff44
y.create.l HWIO_APPS_SMMU_CB0_PMCNTENSET_2_APPS_ADDR A:0x1e10f48
y.create.l HWIO_APPS_SMMU_CB1_PMCNTENSET_2_APPS_ADDR A:0x1e11f48
y.create.l HWIO_APPS_SMMU_CB2_PMCNTENSET_2_APPS_ADDR A:0x1e12f48
y.create.l HWIO_APPS_SMMU_CB3_PMCNTENSET_2_APPS_ADDR A:0x1e13f48
y.create.l HWIO_APPS_SMMU_CB4_PMCNTENSET_2_APPS_ADDR A:0x1e14f48
y.create.l HWIO_APPS_SMMU_CB5_PMCNTENSET_2_APPS_ADDR A:0x1e15f48
y.create.l HWIO_APPS_SMMU_CB6_PMCNTENSET_2_APPS_ADDR A:0x1e16f48
y.create.l HWIO_APPS_SMMU_CB7_PMCNTENSET_2_APPS_ADDR A:0x1e17f48
y.create.l HWIO_APPS_SMMU_CB8_PMCNTENSET_2_APPS_ADDR A:0x1e18f48
y.create.l HWIO_APPS_SMMU_CB9_PMCNTENSET_2_APPS_ADDR A:0x1e19f48
y.create.l HWIO_APPS_SMMU_CB10_PMCNTENSET_2_APPS_ADDR A:0x1e1af48
y.create.l HWIO_APPS_SMMU_CB11_PMCNTENSET_2_APPS_ADDR A:0x1e1bf48
y.create.l HWIO_APPS_SMMU_CB12_PMCNTENSET_2_APPS_ADDR A:0x1e1cf48
y.create.l HWIO_APPS_SMMU_CB13_PMCNTENSET_2_APPS_ADDR A:0x1e1df48
y.create.l HWIO_APPS_SMMU_CB14_PMCNTENSET_2_APPS_ADDR A:0x1e1ef48
y.create.l HWIO_APPS_SMMU_CB15_PMCNTENSET_2_APPS_ADDR A:0x1e1ff48
y.create.l HWIO_APPS_SMMU_CB0_PMINTENCLR_2_APPS_ADDR A:0x1e10f4c
y.create.l HWIO_APPS_SMMU_CB1_PMINTENCLR_2_APPS_ADDR A:0x1e11f4c
y.create.l HWIO_APPS_SMMU_CB2_PMINTENCLR_2_APPS_ADDR A:0x1e12f4c
y.create.l HWIO_APPS_SMMU_CB3_PMINTENCLR_2_APPS_ADDR A:0x1e13f4c
y.create.l HWIO_APPS_SMMU_CB4_PMINTENCLR_2_APPS_ADDR A:0x1e14f4c
y.create.l HWIO_APPS_SMMU_CB5_PMINTENCLR_2_APPS_ADDR A:0x1e15f4c
y.create.l HWIO_APPS_SMMU_CB6_PMINTENCLR_2_APPS_ADDR A:0x1e16f4c
y.create.l HWIO_APPS_SMMU_CB7_PMINTENCLR_2_APPS_ADDR A:0x1e17f4c
y.create.l HWIO_APPS_SMMU_CB8_PMINTENCLR_2_APPS_ADDR A:0x1e18f4c
y.create.l HWIO_APPS_SMMU_CB9_PMINTENCLR_2_APPS_ADDR A:0x1e19f4c
y.create.l HWIO_APPS_SMMU_CB10_PMINTENCLR_2_APPS_ADDR A:0x1e1af4c
y.create.l HWIO_APPS_SMMU_CB11_PMINTENCLR_2_APPS_ADDR A:0x1e1bf4c
y.create.l HWIO_APPS_SMMU_CB12_PMINTENCLR_2_APPS_ADDR A:0x1e1cf4c
y.create.l HWIO_APPS_SMMU_CB13_PMINTENCLR_2_APPS_ADDR A:0x1e1df4c
y.create.l HWIO_APPS_SMMU_CB14_PMINTENCLR_2_APPS_ADDR A:0x1e1ef4c
y.create.l HWIO_APPS_SMMU_CB15_PMINTENCLR_2_APPS_ADDR A:0x1e1ff4c
y.create.l HWIO_APPS_SMMU_CB0_PMOVSCLR_2_APPS_ADDR A:0x1e10f50
y.create.l HWIO_APPS_SMMU_CB1_PMOVSCLR_2_APPS_ADDR A:0x1e11f50
y.create.l HWIO_APPS_SMMU_CB2_PMOVSCLR_2_APPS_ADDR A:0x1e12f50
y.create.l HWIO_APPS_SMMU_CB3_PMOVSCLR_2_APPS_ADDR A:0x1e13f50
y.create.l HWIO_APPS_SMMU_CB4_PMOVSCLR_2_APPS_ADDR A:0x1e14f50
y.create.l HWIO_APPS_SMMU_CB5_PMOVSCLR_2_APPS_ADDR A:0x1e15f50
y.create.l HWIO_APPS_SMMU_CB6_PMOVSCLR_2_APPS_ADDR A:0x1e16f50
y.create.l HWIO_APPS_SMMU_CB7_PMOVSCLR_2_APPS_ADDR A:0x1e17f50
y.create.l HWIO_APPS_SMMU_CB8_PMOVSCLR_2_APPS_ADDR A:0x1e18f50
y.create.l HWIO_APPS_SMMU_CB9_PMOVSCLR_2_APPS_ADDR A:0x1e19f50
y.create.l HWIO_APPS_SMMU_CB10_PMOVSCLR_2_APPS_ADDR A:0x1e1af50
y.create.l HWIO_APPS_SMMU_CB11_PMOVSCLR_2_APPS_ADDR A:0x1e1bf50
y.create.l HWIO_APPS_SMMU_CB12_PMOVSCLR_2_APPS_ADDR A:0x1e1cf50
y.create.l HWIO_APPS_SMMU_CB13_PMOVSCLR_2_APPS_ADDR A:0x1e1df50
y.create.l HWIO_APPS_SMMU_CB14_PMOVSCLR_2_APPS_ADDR A:0x1e1ef50
y.create.l HWIO_APPS_SMMU_CB15_PMOVSCLR_2_APPS_ADDR A:0x1e1ff50
y.create.l HWIO_APPS_SMMU_CB0_PMOVSSET_2_APPS_ADDR A:0x1e10f58
y.create.l HWIO_APPS_SMMU_CB1_PMOVSSET_2_APPS_ADDR A:0x1e11f58
y.create.l HWIO_APPS_SMMU_CB2_PMOVSSET_2_APPS_ADDR A:0x1e12f58
y.create.l HWIO_APPS_SMMU_CB3_PMOVSSET_2_APPS_ADDR A:0x1e13f58
y.create.l HWIO_APPS_SMMU_CB4_PMOVSSET_2_APPS_ADDR A:0x1e14f58
y.create.l HWIO_APPS_SMMU_CB5_PMOVSSET_2_APPS_ADDR A:0x1e15f58
y.create.l HWIO_APPS_SMMU_CB6_PMOVSSET_2_APPS_ADDR A:0x1e16f58
y.create.l HWIO_APPS_SMMU_CB7_PMOVSSET_2_APPS_ADDR A:0x1e17f58
y.create.l HWIO_APPS_SMMU_CB8_PMOVSSET_2_APPS_ADDR A:0x1e18f58
y.create.l HWIO_APPS_SMMU_CB9_PMOVSSET_2_APPS_ADDR A:0x1e19f58
y.create.l HWIO_APPS_SMMU_CB10_PMOVSSET_2_APPS_ADDR A:0x1e1af58
y.create.l HWIO_APPS_SMMU_CB11_PMOVSSET_2_APPS_ADDR A:0x1e1bf58
y.create.l HWIO_APPS_SMMU_CB12_PMOVSSET_2_APPS_ADDR A:0x1e1cf58
y.create.l HWIO_APPS_SMMU_CB13_PMOVSSET_2_APPS_ADDR A:0x1e1df58
y.create.l HWIO_APPS_SMMU_CB14_PMOVSSET_2_APPS_ADDR A:0x1e1ef58
y.create.l HWIO_APPS_SMMU_CB15_PMOVSSET_2_APPS_ADDR A:0x1e1ff58
y.create.l HWIO_APPS_SMMU_CB0_PMAUTHSTATUS_2_APPS_ADDR A:0x1e10fb8
y.create.l HWIO_APPS_SMMU_CB1_PMAUTHSTATUS_2_APPS_ADDR A:0x1e11fb8
y.create.l HWIO_APPS_SMMU_CB2_PMAUTHSTATUS_2_APPS_ADDR A:0x1e12fb8
y.create.l HWIO_APPS_SMMU_CB3_PMAUTHSTATUS_2_APPS_ADDR A:0x1e13fb8
y.create.l HWIO_APPS_SMMU_CB4_PMAUTHSTATUS_2_APPS_ADDR A:0x1e14fb8
y.create.l HWIO_APPS_SMMU_CB5_PMAUTHSTATUS_2_APPS_ADDR A:0x1e15fb8
y.create.l HWIO_APPS_SMMU_CB6_PMAUTHSTATUS_2_APPS_ADDR A:0x1e16fb8
y.create.l HWIO_APPS_SMMU_CB7_PMAUTHSTATUS_2_APPS_ADDR A:0x1e17fb8
y.create.l HWIO_APPS_SMMU_CB8_PMAUTHSTATUS_2_APPS_ADDR A:0x1e18fb8
y.create.l HWIO_APPS_SMMU_CB9_PMAUTHSTATUS_2_APPS_ADDR A:0x1e19fb8
y.create.l HWIO_APPS_SMMU_CB10_PMAUTHSTATUS_2_APPS_ADDR A:0x1e1afb8
y.create.l HWIO_APPS_SMMU_CB11_PMAUTHSTATUS_2_APPS_ADDR A:0x1e1bfb8
y.create.l HWIO_APPS_SMMU_CB12_PMAUTHSTATUS_2_APPS_ADDR A:0x1e1cfb8
y.create.l HWIO_APPS_SMMU_CB13_PMAUTHSTATUS_2_APPS_ADDR A:0x1e1dfb8
y.create.l HWIO_APPS_SMMU_CB14_PMAUTHSTATUS_2_APPS_ADDR A:0x1e1efb8
y.create.l HWIO_APPS_SMMU_CB15_PMAUTHSTATUS_2_APPS_ADDR A:0x1e1ffb8
y.create.l HWIO_SMMU_INTR_SEL_SEC_ADDR A:0x1ef0000
y.create.l HWIO_SMMU_MISC_TIE_OFF_SEC_ADDR A:0x1ef0008
y.create.l HWIO_SMMU_CATS_64_BIT_CTL_SEC_ADDR A:0x1ef0010
y.create.l HWIO_SMMU_APP_TCU_PTW_VMID_SEC_ADDR A:0x1ef0018
y.create.l HWIO_SMMU_SPARE_REG_1_SEC_ADDR A:0x1ef0020
y.create.l HWIO_SMMU_INTR_SEL_NSHYP_ADDR A:0x1ef1000
y.create.l HWIO_SMMU_MSA_BYPASS_ERR_ADDR_NSHYP_ADDR A:0x1ef1008
y.create.l HWIO_SMMU_PTW_ARCH_DBG_MON_CTL_NSHYP_ADDR A:0x1ef1010
y.create.l HWIO_SMMU_PTW_ARCH_DBG_MON_MASK_NSHYP_ADDR A:0x1ef1018
y.create.l HWIO_SMMU_PTW_ARCH_DBG_MON_MATCH_NSHYP_ADDR A:0x1ef1020
y.create.l HWIO_SMMU_PTW_RCH_DBG_MON_CTL_NSHYP_ADDR A:0x1ef1028
y.create.l HWIO_SMMU_PTW_RCH_DBG_MON_MASK_NSHYP_ADDR A:0x1ef1030
y.create.l HWIO_SMMU_PTW_RCH_DBG_MON_MATCH_NSHYP_ADDR A:0x1ef1038
y.create.l HWIO_SMMU_MSA_BYPASS_INTR_EN_NSHYP_ADDR A:0x1ef1040
y.create.l HWIO_SMMU_MSA_BYPASS_INTR_STTS_NSHYP_ADDR A:0x1ef1048
y.create.l HWIO_SMMU_MSA_BYPASS_INTR_CLR_NSHYP_ADDR A:0x1ef1050
y.create.l HWIO_SMMU_PTW_ARCH_DBG_MON_CNTR_NSHYP_ADDR A:0x1ef1058
y.create.l HWIO_SMMU_PTW_ARCH_DBG_MON_SNAP_NSHYP_ADDR A:0x1ef1060
y.create.l HWIO_SMMU_PTW_RCH_DBG_MON_CNTR_NSHYP_ADDR A:0x1ef1068
y.create.l HWIO_SMMU_PTW_RCH_DBG_MON_SNAP_NSHYP_ADDR A:0x1ef1070
y.create.l HWIO_SMMU_INTR_SEL_NS_ADDR A:0x1ef2000
y.create.l HWIO_SMMU_TESTBUS_SEL_NS_ADDR A:0x1ef2008
y.create.l HWIO_SMMU_HW_INFO_NS_ADDR A:0x1ef2010
y.create.l HWIO_SMMU_HW_VERSION_NS_ADDR A:0x1ef2018
y.create.l HWIO_SMMU_MODEM_TBU_VA_PA_MATCH_MSA_ADDR A:0x1ef3000
y.create.l HWIO_SMMU_SID2VMID_SMR_MCDMA_0_ADDR A:0x1ef6000
y.create.l HWIO_SMMU_SID2VMID_SMR_MCDMA_1_ADDR A:0x1ef6008
y.create.l HWIO_SMMU_SID2VMID_FAULT_VMID_MCDMA_ADDR A:0x1ef6010
y.create.l HWIO_SMMU_SID2VMID_FAULT_INTR_EN_MCDMA_ADDR A:0x1ef6018
y.create.l HWIO_SMMU_SID2VMID_FAULT_INTR_STTS_MCDMA_ADDR A:0x1ef6020
y.create.l HWIO_SMMU_SID2VMID_FAULT_INTR_CLR_MCDMA_ADDR A:0x1ef6028
y.create.l HWIO_SMMU_PWR_CTRL_MCDMA_REQ_ADDR A:0x1ef6030
y.create.l HWIO_SMMU_PWR_CTRL_MCDMA_ACK_ADDR A:0x1ef6038
y.create.l HWIO_SMMU_SID2VMID_SMR_GPS_0_ADDR A:0x1ef5000
y.create.l HWIO_SMMU_SID2VMID_SMR_GPS_1_ADDR A:0x1ef5008
y.create.l HWIO_SMMU_SID2VMID_FAULT_VMID_GPS_ADDR A:0x1ef5010
y.create.l HWIO_SMMU_SID2VMID_FAULT_INTR_EN_GPS_ADDR A:0x1ef5018
y.create.l HWIO_SMMU_SID2VMID_FAULT_INTR_STTS_GPS_ADDR A:0x1ef5020
y.create.l HWIO_SMMU_SID2VMID_FAULT_INTR_CLR_GPS_ADDR A:0x1ef5028
y.create.l HWIO_SMMU_PWR_CTRL_GPS_REQ_ADDR A:0x1ef5030
y.create.l HWIO_SMMU_PWR_CTRL_GPS_ACK_ADDR A:0x1ef5038
y.create.l HWIO_SMMU_SID2VMID_SMR_PERIPH_0_ADDR A:0x1ef4000
y.create.l HWIO_SMMU_SID2VMID_SMR_PERIPH_1_ADDR A:0x1ef4008
y.create.l HWIO_SMMU_SID2VMID_SMR_PERIPH_2_ADDR A:0x1ef4010
y.create.l HWIO_SMMU_SID2VMID_SMR_PERIPH_3_ADDR A:0x1ef4018
y.create.l HWIO_SMMU_SID2VMID_SMR_PERIPH_4_ADDR A:0x1ef4020
y.create.l HWIO_SMMU_SID2VMID_SMR_PERIPH_5_ADDR A:0x1ef4028
y.create.l HWIO_SMMU_SID2VMID_SMR_PERIPH_6_ADDR A:0x1ef4030
y.create.l HWIO_SMMU_SID2VMID_SMR_PERIPH_7_ADDR A:0x1ef4038
y.create.l HWIO_SMMU_SID2VMID_SMR_PERIPH_8_ADDR A:0x1ef4040
y.create.l HWIO_SMMU_SID2VMID_SMR_PERIPH_9_ADDR A:0x1ef4048
y.create.l HWIO_SMMU_SID2VMID_FAULT_VMID_PERIPH_ADDR A:0x1ef4178
y.create.l HWIO_SMMU_SID2VMID_FAULT_INTR_EN_PERIPH_ADDR A:0x1ef4180
y.create.l HWIO_SMMU_SID2VMID_FAULT_INTR_STTS_PERIPH_ADDR A:0x1ef4188
y.create.l HWIO_SMMU_SID2VMID_FAULT_INTR_CLR_PERIPH_ADDR A:0x1ef4190
y.create.l HWIO_SMMU_PWR_CTRL_PERIPH_REQ_ADDR A:0x1ef4198
y.create.l HWIO_SMMU_PWR_CTRL_PERIPH_ACK_ADDR A:0x1ef41a0
y.create.l HWIO_SMMU_SID2VMID_SMR_QDSP_0_ADDR A:0x1ef7000
y.create.l HWIO_SMMU_SID2VMID_SMR_QDSP_1_ADDR A:0x1ef7008
y.create.l HWIO_SMMU_SID2VMID_FAULT_VMID_QDSP_ADDR A:0x1ef7010
y.create.l HWIO_SMMU_SID2VMID_FAULT_INTR_EN_QDSP_ADDR A:0x1ef7018
y.create.l HWIO_SMMU_SID2VMID_FAULT_INTR_STTS_QDSP_ADDR A:0x1ef7020
y.create.l HWIO_SMMU_SID2VMID_FAULT_INTR_CLR_QDSP_ADDR A:0x1ef7028
y.create.l HWIO_SPDM_CREG_CFG0_ADDR A:0x40000
y.create.l HWIO_SPDM_CREG_HW_INFO_ADDR A:0x40004
y.create.l HWIO_SPDM_CREG_HW_VERSION_ADDR A:0x40008
y.create.l HWIO_SPDM_CREG_MUTEX_0_ADDR A:0x40100
y.create.l HWIO_SPDM_OLEM_CFG0_ADDR A:0x41000
y.create.l HWIO_SPDM_OLEM_CFG1_ADDR A:0x41004
y.create.l HWIO_SPDM_OLEM_CFG2_ADDR A:0x41008
y.create.l HWIO_SPDM_OLEM_CFG3_ADDR A:0x4100c
y.create.l HWIO_SPDM_OLEM_CFG4_ADDR A:0x41010
y.create.l HWIO_SPDM_OLEM_CFG5_ADDR A:0x41014
y.create.l HWIO_SPDM_OLEM_CFG6_ADDR A:0x41018
y.create.l HWIO_SPDM_OLEM_CYCLE_C0_OUT_ADDR A:0x41020
y.create.l HWIO_SPDM_OLEM_CYCLE_C1_OUT_ADDR A:0x41024
y.create.l HWIO_SPDM_OLEM_CYCLE_C2_OUT_ADDR A:0x41028
y.create.l HWIO_SPDM_OLEM_CYCLE_C3_OUT_ADDR A:0x4102c
y.create.l HWIO_SPDM_OLEM_CYCLE_C4_OUT_ADDR A:0x41030
y.create.l HWIO_SPDM_OLEM_CYCLE_C5_OUT_ADDR A:0x41034
y.create.l HWIO_SPDM_OLEM_CYCLE_C6_OUT_ADDR A:0x41038
y.create.l HWIO_SPDM_OLEM_CYCLE_C7_OUT_ADDR A:0x4103c
y.create.l HWIO_SPDM_OLEM_CYCLE_C8_OUT_ADDR A:0x41040
y.create.l HWIO_SPDM_OLEM_CYCLE_C9_OUT_ADDR A:0x41044
y.create.l HWIO_SPDM_OLEM_EVENT_C0_OUT_ADDR A:0x410a0
y.create.l HWIO_SPDM_OLEM_EVENT_C1_OUT_ADDR A:0x410a4
y.create.l HWIO_SPDM_OLEM_EVENT_C2_OUT_ADDR A:0x410a8
y.create.l HWIO_SPDM_OLEM_EVENT_C3_OUT_ADDR A:0x410ac
y.create.l HWIO_SPDM_OLEM_EVENT_C4_OUT_ADDR A:0x410b0
y.create.l HWIO_SPDM_OLEM_EVENT_C5_OUT_ADDR A:0x410b4
y.create.l HWIO_SPDM_OLEM_EVENT_C6_OUT_ADDR A:0x410b8
y.create.l HWIO_SPDM_OLEM_EVENT_C7_OUT_ADDR A:0x410bc
y.create.l HWIO_SPDM_OLEM_EVENT_C8_OUT_ADDR A:0x410c0
y.create.l HWIO_SPDM_OLEM_EVENT_C9_OUT_ADDR A:0x410c4
y.create.l HWIO_SPDM_OLEM_MULTIBIT_C0_OUT_ADDR A:0x41120
y.create.l HWIO_SPDM_OLEM_MULTIBIT_C1_OUT_ADDR A:0x41124
y.create.l HWIO_SPDM_OLEM_MULTIBIT_C2_OUT_ADDR A:0x41128
y.create.l HWIO_SPDM_OLEM_MULTIBIT_C3_OUT_ADDR A:0x4112c
y.create.l HWIO_SPDM_OLEM_MULTIBIT_C4_OUT_ADDR A:0x41130
y.create.l HWIO_SPDM_OLEM_MULTIBIT_C5_OUT_ADDR A:0x41134
y.create.l HWIO_SPDM_OLEM_MULTIBIT_C6_OUT_ADDR A:0x41138
y.create.l HWIO_SPDM_OLEM_MULTIBIT_C7_OUT_ADDR A:0x4113c
y.create.l HWIO_SPDM_RT_LOW_THRESH_STATUS_ADDR A:0x42000
y.create.l HWIO_SPDM_RT_HIGH_THRESH_STATUS_ADDR A:0x42004
y.create.l HWIO_SPDM_RT_LOW_IRQ_EN_0_ADDR A:0x42010
y.create.l HWIO_SPDM_RT_LOW_IRQ_EN_1_ADDR A:0x42014
y.create.l HWIO_SPDM_RT_LOW_IRQ_EN_2_ADDR A:0x42018
y.create.l HWIO_SPDM_RT_LOW_IRQ_EN_3_ADDR A:0x4201c
y.create.l HWIO_SPDM_RT_HIGH_IRQ_EN_0_ADDR A:0x42020
y.create.l HWIO_SPDM_RT_HIGH_IRQ_EN_1_ADDR A:0x42024
y.create.l HWIO_SPDM_RT_HIGH_IRQ_EN_2_ADDR A:0x42028
y.create.l HWIO_SPDM_RT_HIGH_IRQ_EN_3_ADDR A:0x4202c
y.create.l HWIO_SPDM_RT_IRQ_TIMER_0_ADDR A:0x42030
y.create.l HWIO_SPDM_RT_IRQ_TIMER_1_ADDR A:0x42034
y.create.l HWIO_SPDM_RT_IRQ_TIMER_2_ADDR A:0x42038
y.create.l HWIO_SPDM_RT_IRQ_TIMER_3_ADDR A:0x4203c
y.create.l HWIO_SPDM_RT_DIAG_MUX_SEL_ADDR A:0x42040
y.create.l HWIO_SPDM_RT_MON_EN_ADDR A:0x42050
y.create.l HWIO_SPDM_RT_MON_EN_SET_ADDR A:0x42054
y.create.l HWIO_SPDM_RT_MON_EN_CLEAR_ADDR A:0x42058
y.create.l HWIO_SPDM_RT_MON_RST_ADDR A:0x42060
y.create.l HWIO_SPDM_RT_MON_RST_SET_ADDR A:0x42064
y.create.l HWIO_SPDM_RT_MON_RST_CLEAR_ADDR A:0x42068
y.create.l HWIO_SPDM_RT_MON_CFG_0_ADDR A:0x42100
y.create.l HWIO_SPDM_RT_MON_CFG_1_ADDR A:0x42110
y.create.l HWIO_SPDM_RT_MON_CFG_2_ADDR A:0x42120
y.create.l HWIO_SPDM_RT_MON_CFG_3_ADDR A:0x42130
y.create.l HWIO_SPDM_RT_MON_CFG_4_ADDR A:0x42140
y.create.l HWIO_SPDM_RT_MON_CFG_5_ADDR A:0x42150
y.create.l HWIO_SPDM_RT_MON_CFG_6_ADDR A:0x42160
y.create.l HWIO_SPDM_RT_MON_CFG_7_ADDR A:0x42170
y.create.l HWIO_SPDM_RT_MON_CFG_8_ADDR A:0x42180
y.create.l HWIO_SPDM_RT_MON_CFG_9_ADDR A:0x42190
y.create.l HWIO_SPDM_RT_THRESH_CFG_0_ADDR A:0x42104
y.create.l HWIO_SPDM_RT_THRESH_CFG_1_ADDR A:0x42114
y.create.l HWIO_SPDM_RT_THRESH_CFG_2_ADDR A:0x42124
y.create.l HWIO_SPDM_RT_THRESH_CFG_3_ADDR A:0x42134
y.create.l HWIO_SPDM_RT_THRESH_CFG_4_ADDR A:0x42144
y.create.l HWIO_SPDM_RT_THRESH_CFG_5_ADDR A:0x42154
y.create.l HWIO_SPDM_RT_THRESH_CFG_6_ADDR A:0x42164
y.create.l HWIO_SPDM_RT_THRESH_CFG_7_ADDR A:0x42174
y.create.l HWIO_SPDM_RT_THRESH_CFG_8_ADDR A:0x42184
y.create.l HWIO_SPDM_RT_THRESH_CFG_9_ADDR A:0x42194
y.create.l HWIO_SPDM_RT_MON_STATUS_0_ADDR A:0x42108
y.create.l HWIO_SPDM_RT_MON_STATUS_1_ADDR A:0x42118
y.create.l HWIO_SPDM_RT_MON_STATUS_2_ADDR A:0x42128
y.create.l HWIO_SPDM_RT_MON_STATUS_3_ADDR A:0x42138
y.create.l HWIO_SPDM_RT_MON_STATUS_4_ADDR A:0x42148
y.create.l HWIO_SPDM_RT_MON_STATUS_5_ADDR A:0x42158
y.create.l HWIO_SPDM_RT_MON_STATUS_6_ADDR A:0x42168
y.create.l HWIO_SPDM_RT_MON_STATUS_7_ADDR A:0x42178
y.create.l HWIO_SPDM_RT_MON_STATUS_8_ADDR A:0x42188
y.create.l HWIO_SPDM_RT_MON_STATUS_9_ADDR A:0x42198
y.create.l HWIO_SPDM_SREG_CFG0_ADDR A:0x44000
y.create.l HWIO_SPDM_SREG_CFG1_ADDR A:0x44004
y.create.l HWIO_SPDM_SREG_MUTEX_0_ADDR A:0x44100
y.create.l HWIO_TLMM_XPU_SCR_ADDR A:0x1300000
y.create.l HWIO_TLMM_XPU_SWDR_ADDR A:0x1300004
y.create.l HWIO_TLMM_XPU_PRTN_RACR_SSHADOW_ADDR A:0x1300008
y.create.l HWIO_TLMM_XPU_PRTN_WACR_SSHADOW_ADDR A:0x130000c
y.create.l HWIO_TLMM_XPU_PRTN_START_SSHADOW0_ADDR A:0x1300010
y.create.l HWIO_TLMM_XPU_PRTN_END_SSHADOW0_ADDR A:0x1300018
y.create.l HWIO_TLMM_XPU_SEAR0_ADDR A:0x1300040
y.create.l HWIO_TLMM_XPU_SESR_ADDR A:0x1300048
y.create.l HWIO_TLMM_XPU_SESRRESTORE_ADDR A:0x130004c
y.create.l HWIO_TLMM_XPU_SESYNR0_ADDR A:0x1300050
y.create.l HWIO_TLMM_XPU_SESYNR1_ADDR A:0x1300054
y.create.l HWIO_TLMM_XPU_SESYNR2_ADDR A:0x1300058
y.create.l HWIO_TLMM_XPU_MCR_ADDR A:0x1300100
y.create.l HWIO_TLMM_XPU_MEAR0_ADDR A:0x1300140
y.create.l HWIO_TLMM_XPU_MESR_ADDR A:0x1300148
y.create.l HWIO_TLMM_XPU_MESRRESTORE_ADDR A:0x130014c
y.create.l HWIO_TLMM_XPU_MESYNR0_ADDR A:0x1300150
y.create.l HWIO_TLMM_XPU_MESYNR1_ADDR A:0x1300154
y.create.l HWIO_TLMM_XPU_MESYNR2_ADDR A:0x1300158
y.create.l HWIO_TLMM_XPU_CR_ADDR A:0x1300080
y.create.l HWIO_TLMM_XPU_PRTN_RACR_SHADOW_ADDR A:0x1300088
y.create.l HWIO_TLMM_XPU_PRTN_WACR_SHADOW_ADDR A:0x130008c
y.create.l HWIO_TLMM_XPU_PRTN_START_SHADOW0_ADDR A:0x1300090
y.create.l HWIO_TLMM_XPU_PRTN_END_SHADOW0_ADDR A:0x1300098
y.create.l HWIO_TLMM_XPU_RPU_ACR0_ADDR A:0x13000a0
y.create.l HWIO_TLMM_XPU_EAR0_ADDR A:0x13000c0
y.create.l HWIO_TLMM_XPU_ESR_ADDR A:0x13000c8
y.create.l HWIO_TLMM_XPU_ESRRESTORE_ADDR A:0x13000cc
y.create.l HWIO_TLMM_XPU_ESYNR0_ADDR A:0x13000d0
y.create.l HWIO_TLMM_XPU_ESYNR1_ADDR A:0x13000d4
y.create.l HWIO_TLMM_XPU_ESYNR2_ADDR A:0x13000d8
y.create.l HWIO_TLMM_XPU_UMR_RACR_ADDR A:0x13000e0
y.create.l HWIO_TLMM_XPU_UMR_WACR_ADDR A:0x13000e4
y.create.l HWIO_TLMM_XPU_UMR_CNTL_ADDR A:0x13000f0
y.create.l HWIO_TLMM_XPU_IDR0_ADDR A:0x1300074
y.create.l HWIO_TLMM_XPU_IDR1_ADDR A:0x1300078
y.create.l HWIO_TLMM_XPU_REV_ADDR A:0x130007c
y.create.l HWIO_TLMM_XPU_PRT0_RACR0_ADDR A:0x1300200
y.create.l HWIO_TLMM_XPU_PRT1_RACR0_ADDR A:0x1300280
y.create.l HWIO_TLMM_XPU_PRT2_RACR0_ADDR A:0x1300300
y.create.l HWIO_TLMM_XPU_PRT3_RACR0_ADDR A:0x1300380
y.create.l HWIO_TLMM_XPU_PRT4_RACR0_ADDR A:0x1300400
y.create.l HWIO_TLMM_XPU_PRT5_RACR0_ADDR A:0x1300480
y.create.l HWIO_TLMM_XPU_PRT6_RACR0_ADDR A:0x1300500
y.create.l HWIO_TLMM_XPU_PRT7_RACR0_ADDR A:0x1300580
y.create.l HWIO_TLMM_XPU_PRT8_RACR0_ADDR A:0x1300600
y.create.l HWIO_TLMM_XPU_PRT9_RACR0_ADDR A:0x1300680
y.create.l HWIO_TLMM_XPU_PRT0_WACR0_ADDR A:0x1300220
y.create.l HWIO_TLMM_XPU_PRT1_WACR0_ADDR A:0x13002a0
y.create.l HWIO_TLMM_XPU_PRT2_WACR0_ADDR A:0x1300320
y.create.l HWIO_TLMM_XPU_PRT3_WACR0_ADDR A:0x13003a0
y.create.l HWIO_TLMM_XPU_PRT4_WACR0_ADDR A:0x1300420
y.create.l HWIO_TLMM_XPU_PRT5_WACR0_ADDR A:0x13004a0
y.create.l HWIO_TLMM_XPU_PRT6_WACR0_ADDR A:0x1300520
y.create.l HWIO_TLMM_XPU_PRT7_WACR0_ADDR A:0x13005a0
y.create.l HWIO_TLMM_XPU_PRT8_WACR0_ADDR A:0x1300620
y.create.l HWIO_TLMM_XPU_PRT9_WACR0_ADDR A:0x13006a0
y.create.l HWIO_TLMM_XPU_PRT0_START0_ADDR A:0x1300240
y.create.l HWIO_TLMM_XPU_PRT1_START0_ADDR A:0x13002c0
y.create.l HWIO_TLMM_XPU_PRT2_START0_ADDR A:0x1300340
y.create.l HWIO_TLMM_XPU_PRT3_START0_ADDR A:0x13003c0
y.create.l HWIO_TLMM_XPU_PRT4_START0_ADDR A:0x1300440
y.create.l HWIO_TLMM_XPU_PRT5_START0_ADDR A:0x13004c0
y.create.l HWIO_TLMM_XPU_PRT6_START0_ADDR A:0x1300540
y.create.l HWIO_TLMM_XPU_PRT7_START0_ADDR A:0x13005c0
y.create.l HWIO_TLMM_XPU_PRT8_START0_ADDR A:0x1300640
y.create.l HWIO_TLMM_XPU_PRT9_START0_ADDR A:0x13006c0
y.create.l HWIO_TLMM_XPU_PRT0_END0_ADDR A:0x1300248
y.create.l HWIO_TLMM_XPU_PRT1_END0_ADDR A:0x13002c8
y.create.l HWIO_TLMM_XPU_PRT2_END0_ADDR A:0x1300348
y.create.l HWIO_TLMM_XPU_PRT3_END0_ADDR A:0x13003c8
y.create.l HWIO_TLMM_XPU_PRT4_END0_ADDR A:0x1300448
y.create.l HWIO_TLMM_XPU_PRT5_END0_ADDR A:0x13004c8
y.create.l HWIO_TLMM_XPU_PRT6_END0_ADDR A:0x1300548
y.create.l HWIO_TLMM_XPU_PRT7_END0_ADDR A:0x13005c8
y.create.l HWIO_TLMM_XPU_PRT8_END0_ADDR A:0x1300648
y.create.l HWIO_TLMM_XPU_PRT9_END0_ADDR A:0x13006c8
y.create.l HWIO_TLMM_XPU_PRT0_SCR_ADDR A:0x1300250
y.create.l HWIO_TLMM_XPU_PRT1_SCR_ADDR A:0x13002d0
y.create.l HWIO_TLMM_XPU_PRT2_SCR_ADDR A:0x1300350
y.create.l HWIO_TLMM_XPU_PRT3_SCR_ADDR A:0x13003d0
y.create.l HWIO_TLMM_XPU_PRT4_SCR_ADDR A:0x1300450
y.create.l HWIO_TLMM_XPU_PRT5_SCR_ADDR A:0x13004d0
y.create.l HWIO_TLMM_XPU_PRT6_SCR_ADDR A:0x1300550
y.create.l HWIO_TLMM_XPU_PRT7_SCR_ADDR A:0x13005d0
y.create.l HWIO_TLMM_XPU_PRT8_SCR_ADDR A:0x1300650
y.create.l HWIO_TLMM_XPU_PRT9_SCR_ADDR A:0x13006d0
y.create.l HWIO_TLMM_XPU_PRT0_MCR_ADDR A:0x1300254
y.create.l HWIO_TLMM_XPU_PRT1_MCR_ADDR A:0x13002d4
y.create.l HWIO_TLMM_XPU_PRT2_MCR_ADDR A:0x1300354
y.create.l HWIO_TLMM_XPU_PRT3_MCR_ADDR A:0x13003d4
y.create.l HWIO_TLMM_XPU_PRT4_MCR_ADDR A:0x1300454
y.create.l HWIO_TLMM_XPU_PRT5_MCR_ADDR A:0x13004d4
y.create.l HWIO_TLMM_XPU_PRT6_MCR_ADDR A:0x1300554
y.create.l HWIO_TLMM_XPU_PRT7_MCR_ADDR A:0x13005d4
y.create.l HWIO_TLMM_XPU_PRT8_MCR_ADDR A:0x1300654
y.create.l HWIO_TLMM_XPU_PRT9_MCR_ADDR A:0x13006d4
y.create.l HWIO_TLMM_XPU_PRT0_CNTL0_ADDR A:0x1300258
y.create.l HWIO_TLMM_XPU_PRT1_CNTL0_ADDR A:0x13002d8
y.create.l HWIO_TLMM_XPU_PRT2_CNTL0_ADDR A:0x1300358
y.create.l HWIO_TLMM_XPU_PRT3_CNTL0_ADDR A:0x13003d8
y.create.l HWIO_TLMM_XPU_PRT4_CNTL0_ADDR A:0x1300458
y.create.l HWIO_TLMM_XPU_PRT5_CNTL0_ADDR A:0x13004d8
y.create.l HWIO_TLMM_XPU_PRT6_CNTL0_ADDR A:0x1300558
y.create.l HWIO_TLMM_XPU_PRT7_CNTL0_ADDR A:0x13005d8
y.create.l HWIO_TLMM_XPU_PRT8_CNTL0_ADDR A:0x1300658
y.create.l HWIO_TLMM_XPU_PRT9_CNTL0_ADDR A:0x13006d8
y.create.l HWIO_TLMM_XPU_PRT0_CNTL1_ADDR A:0x130025c
y.create.l HWIO_TLMM_XPU_PRT1_CNTL1_ADDR A:0x13002dc
y.create.l HWIO_TLMM_XPU_PRT2_CNTL1_ADDR A:0x130035c
y.create.l HWIO_TLMM_XPU_PRT3_CNTL1_ADDR A:0x13003dc
y.create.l HWIO_TLMM_XPU_PRT4_CNTL1_ADDR A:0x130045c
y.create.l HWIO_TLMM_XPU_PRT5_CNTL1_ADDR A:0x13004dc
y.create.l HWIO_TLMM_XPU_PRT6_CNTL1_ADDR A:0x130055c
y.create.l HWIO_TLMM_XPU_PRT7_CNTL1_ADDR A:0x13005dc
y.create.l HWIO_TLMM_XPU_PRT8_CNTL1_ADDR A:0x130065c
y.create.l HWIO_TLMM_XPU_PRT9_CNTL1_ADDR A:0x13006dc
y.create.l HWIO_TLMM_GPIO_CFG0_ADDR A:0x1000000
y.create.l HWIO_TLMM_GPIO_CFG1_ADDR A:0x1001000
y.create.l HWIO_TLMM_GPIO_CFG2_ADDR A:0x1002000
y.create.l HWIO_TLMM_GPIO_CFG3_ADDR A:0x1003000
y.create.l HWIO_TLMM_GPIO_CFG4_ADDR A:0x1004000
y.create.l HWIO_TLMM_GPIO_CFG5_ADDR A:0x1005000
y.create.l HWIO_TLMM_GPIO_CFG6_ADDR A:0x1006000
y.create.l HWIO_TLMM_GPIO_CFG7_ADDR A:0x1007000
y.create.l HWIO_TLMM_GPIO_CFG8_ADDR A:0x1008000
y.create.l HWIO_TLMM_GPIO_CFG9_ADDR A:0x1009000
y.create.l HWIO_TLMM_GPIO_IN_OUT0_ADDR A:0x1000004
y.create.l HWIO_TLMM_GPIO_IN_OUT1_ADDR A:0x1001004
y.create.l HWIO_TLMM_GPIO_IN_OUT2_ADDR A:0x1002004
y.create.l HWIO_TLMM_GPIO_IN_OUT3_ADDR A:0x1003004
y.create.l HWIO_TLMM_GPIO_IN_OUT4_ADDR A:0x1004004
y.create.l HWIO_TLMM_GPIO_IN_OUT5_ADDR A:0x1005004
y.create.l HWIO_TLMM_GPIO_IN_OUT6_ADDR A:0x1006004
y.create.l HWIO_TLMM_GPIO_IN_OUT7_ADDR A:0x1007004
y.create.l HWIO_TLMM_GPIO_IN_OUT8_ADDR A:0x1008004
y.create.l HWIO_TLMM_GPIO_IN_OUT9_ADDR A:0x1009004
y.create.l HWIO_TLMM_GPIO_INTR_CFG0_ADDR A:0x1000008
y.create.l HWIO_TLMM_GPIO_INTR_CFG1_ADDR A:0x1001008
y.create.l HWIO_TLMM_GPIO_INTR_CFG2_ADDR A:0x1002008
y.create.l HWIO_TLMM_GPIO_INTR_CFG3_ADDR A:0x1003008
y.create.l HWIO_TLMM_GPIO_INTR_CFG4_ADDR A:0x1004008
y.create.l HWIO_TLMM_GPIO_INTR_CFG5_ADDR A:0x1005008
y.create.l HWIO_TLMM_GPIO_INTR_CFG6_ADDR A:0x1006008
y.create.l HWIO_TLMM_GPIO_INTR_CFG7_ADDR A:0x1007008
y.create.l HWIO_TLMM_GPIO_INTR_CFG8_ADDR A:0x1008008
y.create.l HWIO_TLMM_GPIO_INTR_CFG9_ADDR A:0x1009008
y.create.l HWIO_TLMM_GPIO_INTR_STATUS0_ADDR A:0x100000c
y.create.l HWIO_TLMM_GPIO_INTR_STATUS1_ADDR A:0x100100c
y.create.l HWIO_TLMM_GPIO_INTR_STATUS2_ADDR A:0x100200c
y.create.l HWIO_TLMM_GPIO_INTR_STATUS3_ADDR A:0x100300c
y.create.l HWIO_TLMM_GPIO_INTR_STATUS4_ADDR A:0x100400c
y.create.l HWIO_TLMM_GPIO_INTR_STATUS5_ADDR A:0x100500c
y.create.l HWIO_TLMM_GPIO_INTR_STATUS6_ADDR A:0x100600c
y.create.l HWIO_TLMM_GPIO_INTR_STATUS7_ADDR A:0x100700c
y.create.l HWIO_TLMM_GPIO_INTR_STATUS8_ADDR A:0x100800c
y.create.l HWIO_TLMM_GPIO_INTR_STATUS9_ADDR A:0x100900c
y.create.l HWIO_TLMM_CLK_GATE_EN_ADDR A:0x1100000
y.create.l HWIO_TLMM_IE_CTRL_DISABLE_ADDR A:0x1100004
y.create.l HWIO_TLMM_MPM_WAKEUP_INT_EN_0_ADDR A:0x1100008
y.create.l HWIO_TLMM_MPM_WAKEUP_INT_EN_1_ADDR A:0x110000c
y.create.l HWIO_TLMM_INT_JTAG_CTL_ADDR A:0x1110000
y.create.l HWIO_TLMM_ETM_MODE_ADDR A:0x1110004
y.create.l HWIO_TLMM_DBG_BUS_OUT_SEL_ADDR A:0x1110008
y.create.l HWIO_TLMM_CHIP_MODE_ADDR A:0x111000c
y.create.l HWIO_TLMM_SPARE_ADDR A:0x110e000
y.create.l HWIO_SPARE1_ADDR A:0x111001c
y.create.l HWIO_SPARE2_ADDR A:0x1110020
y.create.l HWIO_TLMM_HW_REVISION_NUMBER_ADDR A:0x1110010
y.create.l HWIO_TLMM_PERIPH_CHAR_TEST_MODE_ADDR A:0x1110014
y.create.l HWIO_TLMM_EBI2_EMMC_GPIO_CFG_ADDR A:0x1111000
y.create.l HWIO_TLMM_HSIC_CAL_PAD_CTL_ADDR A:0x1112000
y.create.l HWIO_TLMM_HSIC_DATA_PAD_CTL_ADDR A:0x1112004
y.create.l HWIO_TLMM_HSIC_STROBE_PAD_CTL_ADDR A:0x1112008
y.create.l HWIO_TLMM_GMAC_MDIO_CTL_ADDR A:0x111200c
y.create.l HWIO_TLMM_PBL_DEBUG_ADDR A:0x1110018
y.create.l HWIO_TLMM_RFFE_CTL_ADDR A:0x1108000
y.create.l HWIO_TLMM_RESOUT_HDRV_CTL_ADDR A:0x110d000
y.create.l HWIO_TLMM_JTAG_HDRV_CTL_ADDR A:0x110c000
y.create.l HWIO_TLMM_PMIC_HDRV_PULL_CTL_ADDR A:0x110b000
y.create.l HWIO_TLMM_SDC1_HDRV_PULL_CTL_ADDR A:0x110a000
y.create.l HWIO_TLMM_SDC2_HDRV_PULL_CTL_ADDR A:0x1109000
y.create.l HWIO_TLMM_MODE_PULL_CTL_ADDR A:0x1107000
y.create.l HWIO_TLMM_QDSD_HDRV_PULL_DEBUG_GPIO_CTL_ADDR A:0x119c000
y.create.l HWIO_TLMM_QDSD_BOOT_CTL_ADDR A:0x119d000
y.create.l HWIO_TLMM_QDSD_CONFIG_CTL_ADDR A:0x119e000
y.create.l HWIO_TLMM_QDSD_STATUS_CTL_ADDR A:0x119f000
y.create.l HWIO_TLMM_QDSD_HYS_CTL_ADDR A:0x11a7000
y.create.l HWIO_TLMM_QDSD_DEBUG_HDRV_PULL_CTL_ADDR A:0x11a0000
y.create.l HWIO_TLMM_QDSD_GPIO_CTL_ADDR A:0x11a1000
y.create.l HWIO_TLMM_QDSD_INTR_ENABLE_CTL_ADDR A:0x11a2000
y.create.l HWIO_TLMM_QDSD_INTR_CLEAR_CTL_ADDR A:0x11a3000
y.create.l HWIO_TLMM_QDSD_SPARE1_CTL_ADDR A:0x11a5000
y.create.l HWIO_TLMM_QDSD_SPARE2_CTL_ADDR A:0x11a6000
y.create.l HWIO_TLMM_QDSD_TIMEOUT_VALUE_CTL_ADDR A:0x11a4000
y.create.l HWIO_TLMM_GPIO_HS_I2C_CTL_ADDR A:0x110f000
y.create.l HWIO_TLMM_DIR_CONN_INTR0_CFG_WCSS_ADDR A:0x1106000
y.create.l HWIO_TLMM_DIR_CONN_INTR1_CFG_WCSS_ADDR A:0x1106004
y.create.l HWIO_TLMM_DIR_CONN_INTR0_CFG_SENSORS_ADDR A:0x1105000
y.create.l HWIO_TLMM_DIR_CONN_INTR1_CFG_SENSORS_ADDR A:0x1105004
y.create.l HWIO_TLMM_DIR_CONN_INTR2_CFG_SENSORS_ADDR A:0x1105008
y.create.l HWIO_TLMM_DIR_CONN_INTR3_CFG_SENSORS_ADDR A:0x110500c
y.create.l HWIO_TLMM_DIR_CONN_INTR4_CFG_SENSORS_ADDR A:0x1105010
y.create.l HWIO_TLMM_DIR_CONN_INTR5_CFG_SENSORS_ADDR A:0x1105014
y.create.l HWIO_TLMM_DIR_CONN_INTR6_CFG_SENSORS_ADDR A:0x1105018
y.create.l HWIO_TLMM_DIR_CONN_INTR7_CFG_SENSORS_ADDR A:0x110501c
y.create.l HWIO_TLMM_DIR_CONN_INTR8_CFG_SENSORS_ADDR A:0x1105020
y.create.l HWIO_TLMM_DIR_CONN_INTR9_CFG_SENSORS_ADDR A:0x1105024
y.create.l HWIO_TLMM_DIR_CONN_INTR0_CFG_LPA_DSP_ADDR A:0x1104000
y.create.l HWIO_TLMM_DIR_CONN_INTR1_CFG_LPA_DSP_ADDR A:0x1104004
y.create.l HWIO_TLMM_DIR_CONN_INTR2_CFG_LPA_DSP_ADDR A:0x1104008
y.create.l HWIO_TLMM_DIR_CONN_INTR3_CFG_LPA_DSP_ADDR A:0x110400c
y.create.l HWIO_TLMM_DIR_CONN_INTR4_CFG_LPA_DSP_ADDR A:0x1104010
y.create.l HWIO_TLMM_DIR_CONN_INTR5_CFG_LPA_DSP_ADDR A:0x1104014
y.create.l HWIO_TLMM_DIR_CONN_INTR0_CFG_RPM_ADDR A:0x1103000
y.create.l HWIO_TLMM_DIR_CONN_INTR0_CFG_APSS_ADDR A:0x1102000
y.create.l HWIO_TLMM_DIR_CONN_INTR1_CFG_APSS_ADDR A:0x1102004
y.create.l HWIO_TLMM_DIR_CONN_INTR2_CFG_APSS_ADDR A:0x1102008
y.create.l HWIO_TLMM_DIR_CONN_INTR3_CFG_APSS_ADDR A:0x110200c
y.create.l HWIO_TLMM_DIR_CONN_INTR4_CFG_APSS_ADDR A:0x1102010
y.create.l HWIO_TLMM_DIR_CONN_INTR5_CFG_APSS_ADDR A:0x1102014
y.create.l HWIO_TLMM_DIR_CONN_INTR6_CFG_APSS_ADDR A:0x1102018
y.create.l HWIO_TLMM_DIR_CONN_INTR7_CFG_APSS_ADDR A:0x110201c
y.create.l HWIO_TLMM_DIR_CONN_INTR0_CFG_MSS_ADDR A:0x1101000
y.create.l HWIO_TLMM_DIR_CONN_INTR1_CFG_MSS_ADDR A:0x1101004
y.create.l HWIO_TLMM_GPIO_OUT_0_ADDR A:0x1200000
y.create.l HWIO_TLMM_GPIO_OUT_1_ADDR A:0x1200004
y.create.l HWIO_TLMM_GPIO_OUT_2_ADDR A:0x1200008
y.create.l HWIO_TLMM_GPIO_OUT_CLR_0_ADDR A:0x1200020
y.create.l HWIO_TLMM_GPIO_OUT_CLR_1_ADDR A:0x1200024
y.create.l HWIO_TLMM_GPIO_OUT_CLR_2_ADDR A:0x1200028
y.create.l HWIO_TLMM_GPIO_OUT_SET_0_ADDR A:0x1200040
y.create.l HWIO_TLMM_GPIO_OUT_SET_1_ADDR A:0x1200044
y.create.l HWIO_TLMM_GPIO_OUT_SET_2_ADDR A:0x1200048
y.create.l HWIO_TLMM_GPIO_IN_0_ADDR A:0x1200060
y.create.l HWIO_TLMM_GPIO_IN_1_ADDR A:0x1200064
y.create.l HWIO_TLMM_GPIO_IN_2_ADDR A:0x1200068
y.create.l HWIO_TLMM_GPIO_OE_0_ADDR A:0x1200080
y.create.l HWIO_TLMM_GPIO_OE_1_ADDR A:0x1200084
y.create.l HWIO_TLMM_GPIO_OE_2_ADDR A:0x1200088
y.create.l HWIO_TLMM_GPIO_OE_CLR_0_ADDR A:0x12000a0
y.create.l HWIO_TLMM_GPIO_OE_CLR_1_ADDR A:0x12000a4
y.create.l HWIO_TLMM_GPIO_OE_CLR_2_ADDR A:0x12000a8
y.create.l HWIO_TLMM_GPIO_OE_SET_0_ADDR A:0x12000c0
y.create.l HWIO_TLMM_GPIO_OE_SET_1_ADDR A:0x12000c4
y.create.l HWIO_TLMM_GPIO_OE_SET_2_ADDR A:0x12000c8
y.create.l HWIO_ULTAUDIO_HW_VERSION_ADDR A:0x7700000
y.create.l HWIO_ULTAUDIO_TCSR_DEBUG_CTL_ADDR A:0x7700004
y.create.l HWIO_LPASS_CSR_GP_CTL_ADDR A:0x7700100
y.create.l HWIO_LPASS_CSR_MEMTYPE_CTL_ADDR A:0x7700104
y.create.l HWIO_LPASS_CSR_DEBUG_BUS_ADDR A:0x7700114
y.create.l HWIO_LPASS_AHBI_CFG_ADDR A:0x7700124
y.create.l HWIO_LPASS_AHBI_LOCK_CTL_ADDR A:0x7700128
y.create.l HWIO_LPASS_AHBI_CFG_EXT_ADDR A:0x770012c
y.create.l HWIO_LPASS_AHBX_CFG_ADDR A:0x7700140
y.create.l HWIO_LPASS_AHBX_LOCK_CTL_ADDR A:0x7700144
y.create.l HWIO_LPASS_AHBIX_SSR_CTL_ADDR A:0x7700148
y.create.l HWIO_LPASS_AHBIX_STATUS_ADDR A:0x7700150
y.create.l HWIO_LPASS_AHBIX_ACK_ADDR A:0x7700154
y.create.l HWIO_LPASS_AHBIX_EN_ADDR A:0x7700158
y.create.l HWIO_LPASS_AUDIO_CORE_LPM_CGCR_ADDR A:0x770015c
y.create.l HWIO_LPASS_AUDIO_CORE_AUDSYNC_CGCR_ADDR A:0x7700160
y.create.l HWIO_LPASS_AUDIO_CORE_AVSYNC_CGCR_ADDR A:0x7700164
y.create.l HWIO_LPASS_AUDIO_CORE_AHB2AHB_CODEC_CGCR_ADDR A:0x770016c
y.create.l HWIO_LPASS_AUDIO_CORE_LPAIF_CTL_CGCR_ADDR A:0x7700170
y.create.l HWIO_LPASS_AUDIO_CORE_VFR_CGCR_ADDR A:0x7700174
y.create.l HWIO_LPASS_AUDIO_CORE_AHB2AHB_PCNOC_SLV_CGCR_ADDR A:0x7700178
y.create.l HWIO_LPASS_AUDIO_CORE_AHB2AHB_PCNOC_MST_CGCR_ADDR A:0x770017c
y.create.l HWIO_LPASS_AUDIO_CORE_AVTIMER_XO_FM_CGCR_ADDR A:0x7700180
y.create.l HWIO_LPASS_AUDIO_CORE_AVTIMER_XO_BT_CGCR_ADDR A:0x7700184
y.create.l HWIO_LPASS_AUDIO_CORE_SLIMBUS_SLV_CGCR_ADDR A:0x7700188
y.create.l HWIO_LPASS_AUDIO_CORE_SLIMBUS_MST_CGCR_ADDR A:0x770018c
y.create.l HWIO_LPASS_LPASS_CSR_ADDR_VALID_STATUS_ADDR A:0x7700190
y.create.l HWIO_LPASS_LPASS_CSR_ADDR_VALID_ACK_ADDR A:0x7700194
y.create.l HWIO_LPASS_LPASS_CSR_ADDR_VALID_EN_ADDR A:0x7700198
y.create.l HWIO_LPASS_LPM_CTL_ADDR A:0x770019c
y.create.l HWIO_LPASS_LPAIF_CTL_ADDR A:0x77001b0
y.create.l HWIO_LPASS_VFR_IRQ_MUX_CTL_ADDR A:0x7701000
y.create.l HWIO_LPASS_VFR_STC_MSB_ADDR A:0x7701004
y.create.l HWIO_LPASS_VFR_STC_LSB_ADDR A:0x7701008
y.create.l HWIO_LPASS_VFR_IRQ_MUX_CTL_1_ADDR A:0x7701010
y.create.l HWIO_LPASS_VFR_STC_MSB_1_ADDR A:0x7701014
y.create.l HWIO_LPASS_VFR_STC_LSB_1_ADDR A:0x7701018
y.create.l HWIO_LPASS_GP_IRQ_TS_MUX_CTL_0_ADDR A:0x7701020
y.create.l HWIO_LPASS_GP_IRQ_STC_MSB_0_ADDR A:0x7701024
y.create.l HWIO_LPASS_GP_IRQ_STC_LSB_0_ADDR A:0x7701028
y.create.l HWIO_LPASS_GP_IRQ_TS_MUX_CTL_1_ADDR A:0x7701030
y.create.l HWIO_LPASS_GP_IRQ_STC_MSB_1_ADDR A:0x7701034
y.create.l HWIO_LPASS_GP_IRQ_STC_LSB_1_ADDR A:0x7701038
y.create.l HWIO_LPASS_LPAIF_VFR_IRQ_CTL_ADDR A:0x7701040
y.create.l HWIO_LPASS_WCN_VFR_IRQ_CTL_ADDR A:0x7701044
y.create.l HWIO_LPASS_AVT_VFR_IRQ_CTL_ADDR A:0x7701048
y.create.l HWIO_LPASS_SLIMBUS_VFR_IRQ_CTL_ADDR A:0x770104c
y.create.l HWIO_LPASS_CSR_GP_IO_MUX_MIC_CTL_ADDR A:0x7702000
y.create.l HWIO_LPASS_CSR_GP_IO_MUX_SPKR_CTL_ADDR A:0x7702004
y.create.l HWIO_LPASS_CSR_GP_LPAIF_PRI_PCM_PRI_MODE_MUXSEL_ADDR A:0x7702008
y.create.l HWIO_LPASS_CSR_GP_LPAIF_SEC_PCM_SEC_MODE_MUXSEL_ADDR A:0x770200c
y.create.l HWIO_LPASS_CSR_GP_LPAIF_TER_PCM_TER_MODE_MUXSEL_ADDR A:0x7702010
y.create.l HWIO_LPASS_CSR_GP_IO_MUX_TER_CTL_ADDR A:0x7702014
y.create.l HWIO_LPASS_AHBI_ABT_HW_VERSION_ADDR A:0x7705000
y.create.l HWIO_LPASS_AHBI_ABT_INST_ID_ADDR A:0x7705004
y.create.l HWIO_LPASS_AHBI_ABT_NUM_SLAVES_ADDR A:0x7705008
y.create.l HWIO_LPASS_AHBI_ABT_TIMER_LOADVAL_ADDR A:0x770500c
y.create.l HWIO_LPASS_AHBI_ABT_TIMER_MODE_ADDR A:0x7705010
y.create.l HWIO_LPASS_AHBI_ABT_INTR_STATUS_ADDR A:0x7705014
y.create.l HWIO_LPASS_AHBI_ABT_INTR_CLEAR_ADDR A:0x7705018
y.create.l HWIO_LPASS_AHBI_ABT_INTR_ENABLE_ADDR A:0x770501c
y.create.l HWIO_LPASS_AHBI_ABT_SYND_VALID_ADDR A:0x7705020
y.create.l HWIO_LPASS_AHBI_ABT_SYND_CLEAR_ADDR A:0x7705024
y.create.l HWIO_LPASS_AHBI_ABT_SYND_ID_ADDR A:0x7705028
y.create.l HWIO_LPASS_AHBI_ABT_SYND_ADDR0_ADDR A:0x770502c
y.create.l HWIO_LPASS_AHBI_ABT_SYND_ADDR1_ADDR A:0x7705030
y.create.l HWIO_LPASS_AHBI_ABT_SYND_HREADY_ADDR A:0x7705034
y.create.l HWIO_LPASS_AVTIMER_HW_VERSION_ADDR A:0x7706000
y.create.l HWIO_LPASS_AVTIMER_CTL_ADDR A:0x7706004
y.create.l HWIO_LPASS_AVTIMER_RESMOD_ADDR A:0x7706008
y.create.l HWIO_LPASS_AVTIMER_TIMER_LSB_ADDR A:0x770600c
y.create.l HWIO_LPASS_AVTIMER_TIMER_MSB_ADDR A:0x7706010
y.create.l HWIO_LPASS_AVTIMER_INT0_LSB_ADDR A:0x7706014
y.create.l HWIO_LPASS_AVTIMER_INT0_MSB_ADDR A:0x7706018
y.create.l HWIO_LPASS_AVTIMER_INT1_LSB_ADDR A:0x770601c
y.create.l HWIO_LPASS_AVTIMER_INT1_MSB_ADDR A:0x7706020
y.create.l HWIO_LPASS_AVTIMER_TIMEOUT_VAL_ADDR A:0x7706024
y.create.l HWIO_LPASS_AVTIMER_L0_VAL_NEXT_ADDR A:0x7706028
y.create.l HWIO_LPASS_AVTIMER_M0_VAL_NEXT_ADDR A:0x770602c
y.create.l HWIO_LPASS_AVTIMER_N0_VAL_NEXT_ADDR A:0x7706030
y.create.l HWIO_LPASS_AVTIMER_L0_VAL_CURR_ADDR A:0x7706034
y.create.l HWIO_LPASS_AVTIMER_M0_VAL_CURR_ADDR A:0x7706038
y.create.l HWIO_LPASS_AVTIMER_N0_VAL_CURR_ADDR A:0x770603c
y.create.l HWIO_LPASS_AVTIMER_MODE_CTL_ADDR A:0x7706040
y.create.l HWIO_LPASS_AVTIMER_LMN_DWT_ADDR A:0x7706044
y.create.l HWIO_LPASS_AVTIMER_LTIME_LSB_ADDR A:0x7706048
y.create.l HWIO_LPASS_AVTIMER_LTIME_MSB_ADDR A:0x770604c
y.create.l HWIO_LPASS_AVTIMER_EXT_STC_LSB_ADDR A:0x7706050
y.create.l HWIO_LPASS_AVTIMER_EXT_STC_MSB_ADDR A:0x7706054
y.create.l HWIO_LPASS_AVTIMER_RTIME_LSB_ADDR A:0x7706058
y.create.l HWIO_LPASS_AVTIMER_RTIME_MSB_ADDR A:0x770605c
y.create.l HWIO_LPASS_AVTIMER_RTIME_CTL_ADDR A:0x7706060
y.create.l HWIO_LPASS_AVTIMER_TIME_CTL_ADDR A:0x7706064
y.create.l HWIO_LPASS_AVTIMER_TIMER_LOAD_LSB_NEXT_ADDR A:0x7706068
y.create.l HWIO_LPASS_AVTIMER_TIMER_LOAD_MSB_NEXT_ADDR A:0x770606c
y.create.l HWIO_LPASS_AVTIMER_TIMER_LOAD_LSB_CURR_ADDR A:0x7706070
y.create.l HWIO_LPASS_AVTIMER_TIMER_LOAD_MSB_CURR_ADDR A:0x7706074
y.create.l HWIO_LPASS_AVTIMER_TIMER_LOAD_DWT_ADDR A:0x7706078
y.create.l HWIO_LPASS_AVTIMER_INT1_ST_ADDR A:0x770607c
y.create.l HWIO_LPASS_AVTIMER_INT0_ST_ADDR A:0x7706080
y.create.l HWIO_LPASS_AVTIMER_INT1_CTL_ADDR A:0x7706084
y.create.l HWIO_LPASS_AVTIMER_INT0_CTL_ADDR A:0x7706088
y.create.l HWIO_LPASS_AVTIMER_INT_ON_ADDR A:0x770608c
y.create.l HWIO_LPASS_AVTIMER_TICK_DIV_ADDR A:0x7706090
y.create.l HWIO_LPASS_LPAIF_VERSION_ADDR A:0x7708000
y.create.l HWIO_LPASS_LPAIF_HW_CONFIG_ADDR A:0x7708004
y.create.l HWIO_LPASS_LPAIF_HW_CONFIG2_ADDR A:0x7708008
y.create.l HWIO_LPASS_LPAIF_DMIC_CTL_ADDR A:0x7708080
y.create.l HWIO_LPASS_LPAIF_DMIC_VOL_CTL0_ADDR A:0x7708084
y.create.l HWIO_LPASS_LPAIF_DMIC_VOL_CTL1_ADDR A:0x7708088
y.create.l HWIO_LPASS_LPAIF_WRDMA_LPBK_MIX_ADDR A:0x7708100
y.create.l HWIO_LPASS_LPAIF_MIXER_CTL_ADDR A:0x7708180
y.create.l HWIO_LPASS_LPAIF_EXT_VFR_ADDR A:0x7708200
y.create.l HWIO_LPASS_LPAIF_DEBUG_CTL_ADDR A:0x7708280
y.create.l HWIO_LPASS_LPAIF_PRI_RATE_DET_CONFIG_ADDR A:0x7708300
y.create.l HWIO_LPASS_LPAIF_PRI_RATE_DET_TARGET1_CONFIG_ADDR A:0x7708304
y.create.l HWIO_LPASS_LPAIF_PRI_RATE_DET_TARGET2_CONFIG_ADDR A:0x7708308
y.create.l HWIO_LPASS_LPAIF_PRI_RATE_BIN_ADDR A:0x770830c
y.create.l HWIO_LPASS_LPAIF_PRI_STC_DIFF_ADDR A:0x7708310
y.create.l HWIO_LPASS_LPAIF_SEC_RATE_DET_CONFIG_ADDR A:0x7708380
y.create.l HWIO_LPASS_LPAIF_SEC_RATE_DET_TARGET1_CONFIG_ADDR A:0x7708384
y.create.l HWIO_LPASS_LPAIF_SEC_RATE_DET_TARGET2_CONFIG_ADDR A:0x7708388
y.create.l HWIO_LPASS_LPAIF_SEC_RATE_BIN_ADDR A:0x770838c
y.create.l HWIO_LPASS_LPAIF_SEC_STC_DIFF_ADDR A:0x7708390
y.create.l HWIO_LPASS_LPAIF_SPARE_ADDR A:0x7708400
y.create.l HWIO_LPASS_LPAIF_I2S_CTL0_ADDR A:0x7709000
y.create.l HWIO_LPASS_LPAIF_I2S_CTL1_ADDR A:0x770a000
y.create.l HWIO_LPASS_LPAIF_I2S_CTL2_ADDR A:0x770b000
y.create.l HWIO_LPASS_LPAIF_PCM_CTL0_ADDR A:0x7709040
y.create.l HWIO_LPASS_LPAIF_PCM_CTL1_ADDR A:0x770a040
y.create.l HWIO_LPASS_LPAIF_PCM_CTL2_ADDR A:0x770b040
y.create.l HWIO_LPASS_LPAIF_PCM_SLOT_CTL0_ADDR A:0x7709044
y.create.l HWIO_LPASS_LPAIF_PCM_SLOT_CTL1_ADDR A:0x770a044
y.create.l HWIO_LPASS_LPAIF_PCM_SLOT_CTL2_ADDR A:0x770b044
y.create.l HWIO_LPASS_LPAIF_PCM_SLOT_CTL2_0_ADDR A:0x7709048
y.create.l HWIO_LPASS_LPAIF_PCM_SLOT_CTL2_1_ADDR A:0x770a048
y.create.l HWIO_LPASS_LPAIF_PCM_SLOT_CTL2_2_ADDR A:0x770b048
y.create.l HWIO_LPASS_LPAIF_PCM_SLOT_CTL3_0_ADDR A:0x770904c
y.create.l HWIO_LPASS_LPAIF_PCM_SLOT_CTL3_1_ADDR A:0x770a04c
y.create.l HWIO_LPASS_LPAIF_PCM_SLOT_CTL3_2_ADDR A:0x770b04c
y.create.l HWIO_LPASS_LPAIF_PCM_TDM_CTL_0_ADDR A:0x7709050
y.create.l HWIO_LPASS_LPAIF_PCM_TDM_CTL_1_ADDR A:0x770a050
y.create.l HWIO_LPASS_LPAIF_PCM_TDM_CTL_2_ADDR A:0x770b050
y.create.l HWIO_LPASS_LPAIF_PCM_TDM_SAMPLE_WIDTH_0_ADDR A:0x7709054
y.create.l HWIO_LPASS_LPAIF_PCM_TDM_SAMPLE_WIDTH_1_ADDR A:0x770a054
y.create.l HWIO_LPASS_LPAIF_PCM_TDM_SAMPLE_WIDTH_2_ADDR A:0x770b054
y.create.l HWIO_LPASS_LPAIF_IRQ_EN0_ADDR A:0x770e000
y.create.l HWIO_LPASS_LPAIF_IRQ_EN1_ADDR A:0x770f000
y.create.l HWIO_LPASS_LPAIF_IRQ_EN2_ADDR A:0x7710000
y.create.l HWIO_LPASS_LPAIF_IRQ_STAT0_ADDR A:0x770e004
y.create.l HWIO_LPASS_LPAIF_IRQ_STAT1_ADDR A:0x770f004
y.create.l HWIO_LPASS_LPAIF_IRQ_STAT2_ADDR A:0x7710004
y.create.l HWIO_LPASS_LPAIF_IRQ_RAW_STAT0_ADDR A:0x770e008
y.create.l HWIO_LPASS_LPAIF_IRQ_RAW_STAT1_ADDR A:0x770f008
y.create.l HWIO_LPASS_LPAIF_IRQ_RAW_STAT2_ADDR A:0x7710008
y.create.l HWIO_LPASS_LPAIF_IRQ_CLEAR0_ADDR A:0x770e00c
y.create.l HWIO_LPASS_LPAIF_IRQ_CLEAR1_ADDR A:0x770f00c
y.create.l HWIO_LPASS_LPAIF_IRQ_CLEAR2_ADDR A:0x771000c
y.create.l HWIO_LPASS_LPAIF_IRQ_FORCE0_ADDR A:0x770e010
y.create.l HWIO_LPASS_LPAIF_IRQ_FORCE1_ADDR A:0x770f010
y.create.l HWIO_LPASS_LPAIF_IRQ_FORCE2_ADDR A:0x7710010
y.create.l HWIO_LPASS_LPAIF_IRQ2_EN0_ADDR A:0x770e040
y.create.l HWIO_LPASS_LPAIF_IRQ2_EN1_ADDR A:0x770f040
y.create.l HWIO_LPASS_LPAIF_IRQ2_EN2_ADDR A:0x7710040
y.create.l HWIO_LPASS_LPAIF_IRQ2_STAT0_ADDR A:0x770e044
y.create.l HWIO_LPASS_LPAIF_IRQ2_STAT1_ADDR A:0x770f044
y.create.l HWIO_LPASS_LPAIF_IRQ2_STAT2_ADDR A:0x7710044
y.create.l HWIO_LPASS_LPAIF_IRQ2_RAW_STAT0_ADDR A:0x770e048
y.create.l HWIO_LPASS_LPAIF_IRQ2_RAW_STAT1_ADDR A:0x770f048
y.create.l HWIO_LPASS_LPAIF_IRQ2_RAW_STAT2_ADDR A:0x7710048
y.create.l HWIO_LPASS_LPAIF_IRQ2_CLEAR0_ADDR A:0x770e04c
y.create.l HWIO_LPASS_LPAIF_IRQ2_CLEAR1_ADDR A:0x770f04c
y.create.l HWIO_LPASS_LPAIF_IRQ2_CLEAR2_ADDR A:0x771004c
y.create.l HWIO_LPASS_LPAIF_IRQ2_FORCE0_ADDR A:0x770e050
y.create.l HWIO_LPASS_LPAIF_IRQ2_FORCE1_ADDR A:0x770f050
y.create.l HWIO_LPASS_LPAIF_IRQ2_FORCE2_ADDR A:0x7710050
y.create.l HWIO_LPASS_LPAIF_RDDMA_CTL0_ADDR A:0x7710400
y.create.l HWIO_LPASS_LPAIF_RDDMA_CTL1_ADDR A:0x7711400
y.create.l HWIO_LPASS_LPAIF_RDDMA_CTL2_ADDR A:0x7712400
y.create.l HWIO_LPASS_LPAIF_RDDMA_BASE0_ADDR A:0x7710404
y.create.l HWIO_LPASS_LPAIF_RDDMA_BASE1_ADDR A:0x7711404
y.create.l HWIO_LPASS_LPAIF_RDDMA_BASE2_ADDR A:0x7712404
y.create.l HWIO_LPASS_LPAIF_RDDMA_BUFF_LEN0_ADDR A:0x7710408
y.create.l HWIO_LPASS_LPAIF_RDDMA_BUFF_LEN1_ADDR A:0x7711408
y.create.l HWIO_LPASS_LPAIF_RDDMA_BUFF_LEN2_ADDR A:0x7712408
y.create.l HWIO_LPASS_LPAIF_RDDMA_CURR_ADDR0_ADDR A:0x771040c
y.create.l HWIO_LPASS_LPAIF_RDDMA_CURR_ADDR1_ADDR A:0x771140c
y.create.l HWIO_LPASS_LPAIF_RDDMA_CURR_ADDR2_ADDR A:0x771240c
y.create.l HWIO_LPASS_LPAIF_RDDMA_PER_LEN0_ADDR A:0x7710410
y.create.l HWIO_LPASS_LPAIF_RDDMA_PER_LEN1_ADDR A:0x7711410
y.create.l HWIO_LPASS_LPAIF_RDDMA_PER_LEN2_ADDR A:0x7712410
y.create.l HWIO_LPASS_LPAIF_RDDMA_PER_CNT0_ADDR A:0x7710414
y.create.l HWIO_LPASS_LPAIF_RDDMA_PER_CNT1_ADDR A:0x7711414
y.create.l HWIO_LPASS_LPAIF_RDDMA_PER_CNT2_ADDR A:0x7712414
y.create.l HWIO_LPASS_LPAIF_RDDMA_FRM0_ADDR A:0x7710418
y.create.l HWIO_LPASS_LPAIF_RDDMA_FRM1_ADDR A:0x7711418
y.create.l HWIO_LPASS_LPAIF_RDDMA_FRM2_ADDR A:0x7712418
y.create.l HWIO_LPASS_LPAIF_RDDMA_FRMCLR0_ADDR A:0x771041c
y.create.l HWIO_LPASS_LPAIF_RDDMA_FRMCLR1_ADDR A:0x771141c
y.create.l HWIO_LPASS_LPAIF_RDDMA_FRMCLR2_ADDR A:0x771241c
y.create.l HWIO_LPASS_LPAIF_RDDMA_SET_BUFF_CNT0_ADDR A:0x7710420
y.create.l HWIO_LPASS_LPAIF_RDDMA_SET_BUFF_CNT1_ADDR A:0x7711420
y.create.l HWIO_LPASS_LPAIF_RDDMA_SET_BUFF_CNT2_ADDR A:0x7712420
y.create.l HWIO_LPASS_LPAIF_RDDMA_SET_PER_CNT0_ADDR A:0x7710424
y.create.l HWIO_LPASS_LPAIF_RDDMA_SET_PER_CNT1_ADDR A:0x7711424
y.create.l HWIO_LPASS_LPAIF_RDDMA_SET_PER_CNT2_ADDR A:0x7712424
y.create.l HWIO_LPASS_LPAIF_RDDMA_STC_LSB0_ADDR A:0x7710428
y.create.l HWIO_LPASS_LPAIF_RDDMA_STC_LSB1_ADDR A:0x7711428
y.create.l HWIO_LPASS_LPAIF_RDDMA_STC_LSB2_ADDR A:0x7712428
y.create.l HWIO_LPASS_LPAIF_RDDMA_STC_MSB0_ADDR A:0x771042c
y.create.l HWIO_LPASS_LPAIF_RDDMA_STC_MSB1_ADDR A:0x771142c
y.create.l HWIO_LPASS_LPAIF_RDDMA_STC_MSB2_ADDR A:0x771242c
y.create.l HWIO_LPASS_LPAIF_RDDMA_PER0_ADDR A:0x7710430
y.create.l HWIO_LPASS_LPAIF_RDDMA_PER1_ADDR A:0x7711430
y.create.l HWIO_LPASS_LPAIF_RDDMA_PER2_ADDR A:0x7712430
y.create.l HWIO_LPASS_LPAIF_RDDMA_PERCLR0_ADDR A:0x7710434
y.create.l HWIO_LPASS_LPAIF_RDDMA_PERCLR1_ADDR A:0x7711434
y.create.l HWIO_LPASS_LPAIF_RDDMA_PERCLR2_ADDR A:0x7712434
y.create.l HWIO_LPASS_LPAIF_RDDMA_BASE_EXT0_ADDR A:0x7710438
y.create.l HWIO_LPASS_LPAIF_RDDMA_BASE_EXT1_ADDR A:0x7711438
y.create.l HWIO_LPASS_LPAIF_RDDMA_BASE_EXT2_ADDR A:0x7712438
y.create.l HWIO_LPASS_LPAIF_RDDMA_CURR_ADDR_EXT0_ADDR A:0x771043c
y.create.l HWIO_LPASS_LPAIF_RDDMA_CURR_ADDR_EXT1_ADDR A:0x771143c
y.create.l HWIO_LPASS_LPAIF_RDDMA_CURR_ADDR_EXT2_ADDR A:0x771243c
y.create.l HWIO_LPASS_LPAIF_WRDMA_CTL0_ADDR A:0x7713000
y.create.l HWIO_LPASS_LPAIF_WRDMA_CTL1_ADDR A:0x7714000
y.create.l HWIO_LPASS_LPAIF_WRDMA_CTL2_ADDR A:0x7715000
y.create.l HWIO_LPASS_LPAIF_WRDMA_BASE0_ADDR A:0x7713004
y.create.l HWIO_LPASS_LPAIF_WRDMA_BASE1_ADDR A:0x7714004
y.create.l HWIO_LPASS_LPAIF_WRDMA_BASE2_ADDR A:0x7715004
y.create.l HWIO_LPASS_LPAIF_WRDMA_BUFF_LEN0_ADDR A:0x7713008
y.create.l HWIO_LPASS_LPAIF_WRDMA_BUFF_LEN1_ADDR A:0x7714008
y.create.l HWIO_LPASS_LPAIF_WRDMA_BUFF_LEN2_ADDR A:0x7715008
y.create.l HWIO_LPASS_LPAIF_WRDMA_CURR_ADDR0_ADDR A:0x771300c
y.create.l HWIO_LPASS_LPAIF_WRDMA_CURR_ADDR1_ADDR A:0x771400c
y.create.l HWIO_LPASS_LPAIF_WRDMA_CURR_ADDR2_ADDR A:0x771500c
y.create.l HWIO_LPASS_LPAIF_WRDMA_PER_LEN0_ADDR A:0x7713010
y.create.l HWIO_LPASS_LPAIF_WRDMA_PER_LEN1_ADDR A:0x7714010
y.create.l HWIO_LPASS_LPAIF_WRDMA_PER_LEN2_ADDR A:0x7715010
y.create.l HWIO_LPASS_LPAIF_WRDMA_PER_CNT0_ADDR A:0x7713014
y.create.l HWIO_LPASS_LPAIF_WRDMA_PER_CNT1_ADDR A:0x7714014
y.create.l HWIO_LPASS_LPAIF_WRDMA_PER_CNT2_ADDR A:0x7715014
y.create.l HWIO_LPASS_LPAIF_WRDMA_FRM0_ADDR A:0x7713018
y.create.l HWIO_LPASS_LPAIF_WRDMA_FRM1_ADDR A:0x7714018
y.create.l HWIO_LPASS_LPAIF_WRDMA_FRM2_ADDR A:0x7715018
y.create.l HWIO_LPASS_LPAIF_WRDMA_FRMCLR0_ADDR A:0x771301c
y.create.l HWIO_LPASS_LPAIF_WRDMA_FRMCLR1_ADDR A:0x771401c
y.create.l HWIO_LPASS_LPAIF_WRDMA_FRMCLR2_ADDR A:0x771501c
y.create.l HWIO_LPASS_LPAIF_WRDMA_SET_BUFF_CNT0_ADDR A:0x7713020
y.create.l HWIO_LPASS_LPAIF_WRDMA_SET_BUFF_CNT1_ADDR A:0x7714020
y.create.l HWIO_LPASS_LPAIF_WRDMA_SET_BUFF_CNT2_ADDR A:0x7715020
y.create.l HWIO_LPASS_LPAIF_WRDMA_SET_PER_CNT0_ADDR A:0x7713024
y.create.l HWIO_LPASS_LPAIF_WRDMA_SET_PER_CNT1_ADDR A:0x7714024
y.create.l HWIO_LPASS_LPAIF_WRDMA_SET_PER_CNT2_ADDR A:0x7715024
y.create.l HWIO_LPASS_LPAIF_WRDMA_STC_LSB0_ADDR A:0x7713028
y.create.l HWIO_LPASS_LPAIF_WRDMA_STC_LSB1_ADDR A:0x7714028
y.create.l HWIO_LPASS_LPAIF_WRDMA_STC_LSB2_ADDR A:0x7715028
y.create.l HWIO_LPASS_LPAIF_WRDMA_STC_MSB0_ADDR A:0x771302c
y.create.l HWIO_LPASS_LPAIF_WRDMA_STC_MSB1_ADDR A:0x771402c
y.create.l HWIO_LPASS_LPAIF_WRDMA_STC_MSB2_ADDR A:0x771502c
y.create.l HWIO_LPASS_LPAIF_WRDMA_PER0_ADDR A:0x7713030
y.create.l HWIO_LPASS_LPAIF_WRDMA_PER1_ADDR A:0x7714030
y.create.l HWIO_LPASS_LPAIF_WRDMA_PER2_ADDR A:0x7715030
y.create.l HWIO_LPASS_LPAIF_WRDMA_PERCLR0_ADDR A:0x7713034
y.create.l HWIO_LPASS_LPAIF_WRDMA_PERCLR1_ADDR A:0x7714034
y.create.l HWIO_LPASS_LPAIF_WRDMA_PERCLR2_ADDR A:0x7715034
y.create.l HWIO_LPASS_LPAIF_WRDMA_BASE_EXT0_ADDR A:0x7713038
y.create.l HWIO_LPASS_LPAIF_WRDMA_BASE_EXT1_ADDR A:0x7714038
y.create.l HWIO_LPASS_LPAIF_WRDMA_BASE_EXT2_ADDR A:0x7715038
y.create.l HWIO_LPASS_LPAIF_WRDMA_CURR_ADDR_EXT0_ADDR A:0x771303c
y.create.l HWIO_LPASS_LPAIF_WRDMA_CURR_ADDR_EXT1_ADDR A:0x771403c
y.create.l HWIO_LPASS_LPAIF_WRDMA_CURR_ADDR_EXT2_ADDR A:0x771503c
y.create.l HWIO_USB2_HSIC_USB_OTG_HS_ID_ADDR A:0x7c00000
y.create.l HWIO_USB2_HSIC_USB_OTG_HS_HWGENERAL_ADDR A:0x7c00004
y.create.l HWIO_USB2_HSIC_USB_OTG_HS_HWHOST_ADDR A:0x7c00008
y.create.l HWIO_USB2_HSIC_USB_OTG_HS_HWDEVICE_ADDR A:0x7c0000c
y.create.l HWIO_USB2_HSIC_USB_OTG_HS_HWTXBUF_ADDR A:0x7c00010
y.create.l HWIO_USB2_HSIC_USB_OTG_HS_HWRXBUF_ADDR A:0x7c00014
y.create.l HWIO_USB2_HSIC_USB_OTG_HS_SCRATCH_RAM0_ADDR A:0x7c00040
y.create.l HWIO_USB2_HSIC_USB_OTG_HS_SCRATCH_RAM1_ADDR A:0x7c00044
y.create.l HWIO_USB2_HSIC_USB_OTG_HS_SCRATCH_RAM2_ADDR A:0x7c00048
y.create.l HWIO_USB2_HSIC_USB_OTG_HS_SCRATCH_RAM3_ADDR A:0x7c0004c
y.create.l HWIO_USB2_HSIC_USB_OTG_HS_SCRATCH_RAM4_ADDR A:0x7c00050
y.create.l HWIO_USB2_HSIC_USB_OTG_HS_SCRATCH_RAM5_ADDR A:0x7c00054
y.create.l HWIO_USB2_HSIC_USB_OTG_HS_SCRATCH_RAM6_ADDR A:0x7c00058
y.create.l HWIO_USB2_HSIC_USB_OTG_HS_SCRATCH_RAM7_ADDR A:0x7c0005c
y.create.l HWIO_USB2_HSIC_USB_OTG_HS_SCRATCH_RAM8_ADDR A:0x7c00060
y.create.l HWIO_USB2_HSIC_USB_OTG_HS_SCRATCH_RAM9_ADDR A:0x7c00064
y.create.l HWIO_USB2_HSIC_USB_OTG_HS_GPTIMER0LD_ADDR A:0x7c00080
y.create.l HWIO_USB2_HSIC_USB_OTG_HS_GPTIMER0CTRL_ADDR A:0x7c00084
y.create.l HWIO_USB2_HSIC_USB_OTG_HS_GPTIMER1LD_ADDR A:0x7c00088
y.create.l HWIO_USB2_HSIC_USB_OTG_HS_GPTIMER1CTRL_ADDR A:0x7c0008c
y.create.l HWIO_USB2_HSIC_USB_OTG_HS_AHB_BURST_ADDR A:0x7c00090
y.create.l HWIO_USB2_HSIC_USB_OTG_HS_XTOR_STS_ADDR A:0x7c00094
y.create.l HWIO_USB2_HSIC_USB_OTG_HS_AHB_MODE_ADDR A:0x7c00098
y.create.l HWIO_USB2_HSIC_USB_OTG_HS_GEN_CONFIG_ADDR A:0x7c0009c
y.create.l HWIO_USB2_HSIC_USB_OTG_HS_GEN_CONFIG_2_ADDR A:0x7c000a0
y.create.l HWIO_USB2_HSIC_USB_OTG_HS_CAPLENGTH_ADDR A:0x7c00100
y.create.l HWIO_USB2_HSIC_USB_OTG_HS_HCSPARAMS_ADDR A:0x7c00104
y.create.l HWIO_USB2_HSIC_USB_OTG_HS_HCCPARAMS_ADDR A:0x7c00108
y.create.l HWIO_USB2_HSIC_USB_OTG_HS_DCIVERSION_ADDR A:0x7c00120
y.create.l HWIO_USB2_HSIC_USB_OTG_HS_DCCPARAMS_ADDR A:0x7c00124
y.create.l HWIO_USB2_HSIC_USB_OTG_HS_USBCMD_ADDR A:0x7c00140
y.create.l HWIO_USB2_HSIC_USB_OTG_HS_USBSTS_ADDR A:0x7c00144
y.create.l HWIO_USB2_HSIC_USB_OTG_HS_USBINTR_ADDR A:0x7c00148
y.create.l HWIO_USB2_HSIC_USB_OTG_HS_FRINDEX_ADDR A:0x7c0014c
y.create.l HWIO_USB2_HSIC_USB_OTG_HS_PERIODICLISTBASE_ADDR A:0x7c00154
y.create.l HWIO_USB2_HSIC_USB_OTG_HS_DEVICEADDR_ADDR A:0x7c00154
y.create.l HWIO_USB2_HSIC_USB_OTG_HS_ASYNCLISTADDR_ADDR A:0x7c00158
y.create.l HWIO_USB2_HSIC_USB_OTG_HS_ENDPOINTLISTADDR_ADDR A:0x7c00158
y.create.l HWIO_USB2_HSIC_USB_OTG_HS_TTCTRL_ADDR A:0x7c0015c
y.create.l HWIO_USB2_HSIC_USB_OTG_HS_BURSTSIZE_ADDR A:0x7c00160
y.create.l HWIO_USB2_HSIC_USB_OTG_HS_TXFILLTUNING_ADDR A:0x7c00164
y.create.l HWIO_USB2_HSIC_USB_OTG_HS_ULPI_VIEWPORT_ADDR A:0x7c00170
y.create.l HWIO_USB2_HSIC_USB_OTG_HS_ENDPTNAK_ADDR A:0x7c00178
y.create.l HWIO_USB2_HSIC_USB_OTG_HS_ENDPTNAKEN_ADDR A:0x7c0017c
y.create.l HWIO_USB2_HSIC_USB_OTG_HS_PORTSC_ADDR A:0x7c00184
y.create.l HWIO_USB2_HSIC_USB_OTG_HS_OTGSC_ADDR A:0x7c001a4
y.create.l HWIO_USB2_HSIC_USB_OTG_HS_USBMODE_ADDR A:0x7c001a8
y.create.l HWIO_USB2_HSIC_USB_OTG_HS_ENDPTSETUPSTAT_ADDR A:0x7c001ac
y.create.l HWIO_USB2_HSIC_USB_OTG_HS_ENDPTPRIME_ADDR A:0x7c001b0
y.create.l HWIO_USB2_HSIC_USB_OTG_HS_ENDPTFLUSH_ADDR A:0x7c001b4
y.create.l HWIO_USB2_HSIC_USB_OTG_HS_ENDPTSTAT_ADDR A:0x7c001b8
y.create.l HWIO_USB2_HSIC_USB_OTG_HS_ENDPTCOMPLETE_ADDR A:0x7c001bc
y.create.l HWIO_USB2_HSIC_USB_OTG_HS_ENDPTCTRL0_ADDR A:0x7c001c0
y.create.l HWIO_USB2_HSIC_USB_OTG_HS_ENDPTCTRL1_ADDR A:0x7c001c4
y.create.l HWIO_USB2_HSIC_USB_OTG_HS_ENDPTCTRL2_ADDR A:0x7c001c8
y.create.l HWIO_USB2_HSIC_USB_OTG_HS_ENDPTCTRL3_ADDR A:0x7c001cc
y.create.l HWIO_USB2_HSIC_USB_OTG_HS_ENDPTCTRL4_ADDR A:0x7c001d0
y.create.l HWIO_USB2_HSIC_USB_OTG_HS_ENDPTCTRL5_ADDR A:0x7c001d4
y.create.l HWIO_USB2_HSIC_USB_OTG_HS_ENDPTCTRL6_ADDR A:0x7c001d8
y.create.l HWIO_USB2_HSIC_USB_OTG_HS_ENDPTCTRL7_ADDR A:0x7c001dc
y.create.l HWIO_USB2_HSIC_USB_OTG_HS_ENDPTCTRL8_ADDR A:0x7c001e0
y.create.l HWIO_USB2_HSIC_USB_OTG_HS_ENDPTCTRL9_ADDR A:0x7c001e4
y.create.l HWIO_USB2_HSIC_USB_OTG_HS_ENDPTCTRL10_ADDR A:0x7c001e8
y.create.l HWIO_USB2_HSIC_USB_OTG_HS_GENERIC1_ADDR A:0x7c00244
y.create.l HWIO_USB2_HSIC_USB_OTG_HS_GENERIC2_ADDR A:0x7c00248
y.create.l HWIO_USB2_HSIC_USB_OTG_HS_L1_EP_CTRL_ADDR A:0x7c00250
y.create.l HWIO_USB2_HSIC_USB_OTG_HS_L1_CONFIG_ADDR A:0x7c00254
y.create.l HWIO_USB2_HSIC_USB_OTG_HS_LPM_DEBUG_1_ADDR A:0x7c00258
y.create.l HWIO_USB2_HSIC_USB_OTG_HS_LPM_DEBUG_2_ADDR A:0x7c0025c
y.create.l HWIO_USB2_HSIC_USB_OTG_HS_LPM_ATTRIBUTES_ADDR A:0x7c00260
y.create.l HWIO_USB2_HSIC_USB_OTG_HS_LPM_TIMERS_ADDR A:0x7c00264
y.create.l HWIO_USB2_HSIC_USB_OTG_HS_HW_VER_ADDR A:0x7c00270
y.create.l HWIO_USB2_HSIC_USB_OTG_HS_TEST_BUS_ADDR A:0x7c00274
y.create.l HWIO_USB2_HSIC_USB_OTG_HS_BTO_TIME_HS_ADDR A:0x7c00340
y.create.l HWIO_USB2_HSIC_USB_OTG_HS_BTO_TIME_FS_LS_ADDR A:0x7c00344
y.create.l HWIO_USB2_HSIC_USB_OTG_HS_QSB_VALUES_ADDR A:0x7c00348
y.create.l HWIO_USB2_HSIC_USB_OTG_HS_DMA_STUCK_TIMER_ADDR A:0x7c00350
y.create.l HWIO_USB2_HSIC_USB_OTG_HS_SM_OVERRIDE_ADDR A:0x7c00360
y.create.l HWIO_USB2_HSIC_USB_OTG_HS_SM_FENCE_ADDR A:0x7c00364
y.create.l HWIO_USB2_HSIC_USB_OTG_HS_SM_STATE_ADDR A:0x7c00368
y.create.l HWIO_USB2_HSIC_USB_OTG_HS_SPARE_REG_ADDR A:0x7c0036c
y.create.l HWIO_USB2_HSIC_USB_OTG_HS_APF_DBG_CNT_CTRL_ADDR A:0x7c00370
y.create.l HWIO_USB2_HSIC_USB_OTG_HS_APF_DBG_CNT_VAL_ADDR A:0x7c00374
y.create.l HWIO_USB2_HSIC_USB_OTG_HS_APF_DBG_CNT_TRESHOLD_ADDR A:0x7c00378
y.create.l HWIO_USB2_HSIC_USB_OTG_HS_APF_CTRL_ADDR A:0x7c00380
y.create.l HWIO_USB2_HSIC_USB_OTG_HS_APF_DBG_ADDR A:0x7c00384
y.create.l HWIO_USB2_HSIC_USB_OTG_HS_APF_AXI_OVERRIDE_ADDR A:0x7c00388
y.create.l HWIO_USB2_HSIC_USB_OTG_HS_APF_ERR_ADDR_ADDR A:0x7c00390
y.create.l HWIO_USB2_HSIC_USB_OTG_HS_APF_ERR_CTRL_ADDR A:0x7c00394
y.create.l HWIO_USB2_HSIC_USB_OTG_HS_APF_ERR_DATA_LSB_ADDR A:0x7c00398
y.create.l HWIO_USB2_HSIC_USB_OTG_HS_APF_ERR_DATA_MSB_ADDR A:0x7c0039c
y.create.l HWIO_USB2_HSIC_USB_OTG_HS_APF_STS_ADDR A:0x7c003a0
y.create.l HWIO_USB2_HSIC_USB_OTG_HS_APF_STS_CLR_ADDR A:0x7c003a4
y.create.l HWIO_USB2_HSIC_USB_OTG_HS_APF_TIMEOUT_ADDR A:0x7c003a8
y.create.l HWIO_USB2_HSIC_USB_OTG_HS_USBSTS_2_ADDR A:0x7c003c0
y.create.l HWIO_USB2_HSIC_USB_OTG_HS_USBINTR_2_ADDR A:0x7c003c4
y.create.l HWIO_USB2_HSIC_USB_OTG_HS_AHB_STALL_TIMEOUT_ADDR A:0x7c003c8
y.create.l HWIO_USB2_HSIC_USB_OTG_HS_AHB_STALL_ADDR_ADDR A:0x7c003cc
y.create.l HWIO_USB2_PHY_USB_PHY_REVISION_ID0_ADDR A:0x6c000
y.create.l HWIO_USB2_PHY_USB_PHY_REVISION_ID1_ADDR A:0x6c004
y.create.l HWIO_USB2_PHY_USB_PHY_REVISION_ID2_ADDR A:0x6c008
y.create.l HWIO_USB2_PHY_USB_PHY_REVISION_ID3_ADDR A:0x6c00c
y.create.l HWIO_USB2_PHY_USB_PHY_DEBUG_BUS_STAT0_ADDR A:0x6c010
y.create.l HWIO_USB2_PHY_USB_PHY_DEBUG_BUS_STAT1_ADDR A:0x6c014
y.create.l HWIO_USB2_PHY_USB_PHY_DEBUG_BUS_STAT2_ADDR A:0x6c018
y.create.l HWIO_USB2_PHY_USB_PHY_DEBUG_BUS_STAT3_ADDR A:0x6c01c
y.create.l HWIO_USB2_PHY_USB_PHY_HS_RX_TESTER_OUT_1_ADDR A:0x6c020
y.create.l HWIO_USB2_PHY_USB_PHY_CHARGING_DET_OUTPUT_ADDR A:0x6c024
y.create.l HWIO_USB2_PHY_USB_PHY_HS_PHY_IRQ_STAT_ADDR A:0x6c028
y.create.l HWIO_USB2_PHY_USB_PHY_HS_PHY_TEST_OUT_1_ADDR A:0x6c02c
y.create.l HWIO_USB2_PHY_USB_PHY_UTMI_VEC4_STATUS_ADDR A:0x6c030
y.create.l HWIO_USB2_PHY_USB_PHY_ULPI_VEC0_STATUS_ADDR A:0x6c034
y.create.l HWIO_USB2_PHY_USB_PHY_ULPI_VEC1_STATUS_ADDR A:0x6c038
y.create.l HWIO_USB2_PHY_USB_PHY_INTERRUPT_STATUS0_ADDR A:0x6c03c
y.create.l HWIO_USB2_PHY_USB_PHY_INTERRUPT_STATUS1_ADDR A:0x6c040
y.create.l HWIO_USB2_PHY_USB_PHY_RX_CHK_ERR_CNT1_STATUS_ADDR A:0x6c044
y.create.l HWIO_USB2_PHY_USB_PHY_RX_CHK_STATUS_ADDR A:0x6c048
y.create.l HWIO_USB2_PHY_USB_PHY_REFCLK_RXTAP_TEST_STATUS_ADDR A:0x6c04c
y.create.l HWIO_USB2_PHY_USB_PHY_UTMI_RX_DATAL_STATUS_ADDR A:0x6c050
y.create.l HWIO_USB2_PHY_USB_PHY_UTMI_RX_DATAH_STATUS_ADDR A:0x6c054
y.create.l HWIO_USB2_PHY_USB_PHY_UTMI_RX_PORT_STATUS_ADDR A:0x6c058
y.create.l HWIO_USB2_PHY_USB_PHY_INTERRUPT_SRC_STATUS_ADDR A:0x6c05c
y.create.l HWIO_USB2_PHY_USB_PHY_UTMI_CTRL0_ADDR A:0x6c060
y.create.l HWIO_USB2_PHY_USB_PHY_UTMI_CTRL1_ADDR A:0x6c064
y.create.l HWIO_USB2_PHY_USB_PHY_UTMI_CTRL2_ADDR A:0x6c068
y.create.l HWIO_USB2_PHY_USB_PHY_UTMI_CTRL3_ADDR A:0x6c06c
y.create.l HWIO_USB2_PHY_USB_PHY_UTMI_CTRL4_ADDR A:0x6c070
y.create.l HWIO_USB2_PHY_USB_PHY_UTMI_CTRL5_ADDR A:0x6c074
y.create.l HWIO_USB2_PHY_USB_PHY_HS_PHY_CTRL_COMMON0_ADDR A:0x6c078
y.create.l HWIO_USB2_PHY_USB_PHY_HS_PHY_CTRL_COMMON1_ADDR A:0x6c07c
y.create.l HWIO_USB2_PHY_USB_PHY_HS_PHY_CTRL_COMMON2_ADDR A:0x6c080
y.create.l HWIO_USB2_PHY_USB_PHY_HS_PHY_CTRL_COMMON3_ADDR A:0x6c084
y.create.l HWIO_USB2_PHY_USB_PHY_HS_PHY_CTRL0_ADDR A:0x6c088
y.create.l HWIO_USB2_PHY_USB_PHY_HS_PHY_CTRL1_ADDR A:0x6c08c
y.create.l HWIO_USB2_PHY_USB_PHY_HS_PHY_CTRL2_ADDR A:0x6c090
y.create.l HWIO_USB2_PHY_USB_PHY_HS_PHY_CTRL3_ADDR A:0x6c094
y.create.l HWIO_USB2_PHY_USB_PHY_PARAMETER_OVERRIDE_X0_ADDR A:0x6c098
y.create.l HWIO_USB2_PHY_USB_PHY_PARAMETER_OVERRIDE_X1_ADDR A:0x6c09c
y.create.l HWIO_USB2_PHY_USB_PHY_PARAMETER_OVERRIDE_X2_ADDR A:0x6c0a0
y.create.l HWIO_USB2_PHY_USB_PHY_PARAMETER_OVERRIDE_X3_ADDR A:0x6c0a4
y.create.l HWIO_USB2_PHY_USB_PHY_CHARGING_DET_CTRL_ADDR A:0x6c0a8
y.create.l HWIO_USB2_PHY_USB_PHY_HS_PHY_TEST0_ADDR A:0x6c0ac
y.create.l HWIO_USB2_PHY_USB_PHY_HS_PHY_TEST1_ADDR A:0x6c0b0
y.create.l HWIO_USB2_PHY_USB_PHY_HS_RX_TESTER_1_REG0_ADDR A:0x6c0b4
y.create.l HWIO_USB2_PHY_USB_PHY_HS_RX_TESTER_1_REG1_ADDR A:0x6c0b8
y.create.l HWIO_USB2_PHY_USB_PHY_HS_RX_TESTER_1_REG3_ADDR A:0x6c0bc
y.create.l HWIO_USB2_PHY_USB_PHY_TCSR_CTRL_ADDR A:0x6c0c0
y.create.l HWIO_USB2_PHY_USB_PHY_CFG0_ADDR A:0x6c0c4
y.create.l HWIO_USB2_PHY_UTMI_PHY_CMN_CTRL0_ADDR A:0x6c0c8
y.create.l HWIO_USB2_PHY_UTMI_PHY_CMN_CTRL1_ADDR A:0x6c0cc
y.create.l HWIO_USB2_PHY_USB_PHY_IRQ_CMD_ADDR A:0x6c0d0
y.create.l HWIO_USB2_PHY_USB_PHY_INTERRUPT_MASK0_ADDR A:0x6c0d4
y.create.l HWIO_USB2_PHY_USB_PHY_INTERRUPT_MASK1_ADDR A:0x6c0d8
y.create.l HWIO_USB2_PHY_USB_PHY_INTERRUPT_CLEAR0_ADDR A:0x6c0dc
y.create.l HWIO_USB2_PHY_USB_PHY_INTERRUPT_CLEAR1_ADDR A:0x6c0e0
y.create.l HWIO_USB2_PHY_USB_PHY_REFCLK_CTRL_ADDR A:0x6c0e8
y.create.l HWIO_USB2_PHY_USB_PHY_PWRDOWN_CTRL_ADDR A:0x6c0ec
y.create.l HWIO_USB2_PHY_USB_PHY_ULPI_OVERRIDE_7_0_ADDR A:0x6c0f0
y.create.l HWIO_USB2_PHY_USB_PHY_ULPI_OVERRIDE_15_8_ADDR A:0x6c0f4
y.create.l HWIO_USB2_PHY_USB_PHY_ULPI_OVERRIDE_23_16_ADDR A:0x6c0f8
y.create.l HWIO_USB2_PHY_USB_PHY_ULPI_OVERRIDE_31_24_ADDR A:0x6c0fc
y.create.l HWIO_USB2_PHY_USB_PHY_TEST_DEBUG_CTRL_ADDR A:0x6c104
y.create.l HWIO_USB2_PHY_USB_PHY_RESET_CTRL_ADDR A:0x6c108
y.create.l HWIO_USB_OTG_HS_ID_ADDR A:0x78d9000
y.create.l HWIO_USB_OTG_HS_HWGENERAL_ADDR A:0x78d9004
y.create.l HWIO_USB_OTG_HS_HWHOST_ADDR A:0x78d9008
y.create.l HWIO_USB_OTG_HS_HWDEVICE_ADDR A:0x78d900c
y.create.l HWIO_USB_OTG_HS_HWTXBUF_ADDR A:0x78d9010
y.create.l HWIO_USB_OTG_HS_HWRXBUF_ADDR A:0x78d9014
y.create.l HWIO_USB_OTG_HS_SCRATCH_RAM0_ADDR A:0x78d9040
y.create.l HWIO_USB_OTG_HS_SCRATCH_RAM1_ADDR A:0x78d9044
y.create.l HWIO_USB_OTG_HS_SCRATCH_RAM2_ADDR A:0x78d9048
y.create.l HWIO_USB_OTG_HS_SCRATCH_RAM3_ADDR A:0x78d904c
y.create.l HWIO_USB_OTG_HS_SCRATCH_RAM4_ADDR A:0x78d9050
y.create.l HWIO_USB_OTG_HS_SCRATCH_RAM5_ADDR A:0x78d9054
y.create.l HWIO_USB_OTG_HS_SCRATCH_RAM6_ADDR A:0x78d9058
y.create.l HWIO_USB_OTG_HS_SCRATCH_RAM7_ADDR A:0x78d905c
y.create.l HWIO_USB_OTG_HS_SCRATCH_RAM8_ADDR A:0x78d9060
y.create.l HWIO_USB_OTG_HS_SCRATCH_RAM9_ADDR A:0x78d9064
y.create.l HWIO_USB_OTG_HS_GPTIMER0LD_ADDR A:0x78d9080
y.create.l HWIO_USB_OTG_HS_GPTIMER0CTRL_ADDR A:0x78d9084
y.create.l HWIO_USB_OTG_HS_GPTIMER1LD_ADDR A:0x78d9088
y.create.l HWIO_USB_OTG_HS_GPTIMER1CTRL_ADDR A:0x78d908c
y.create.l HWIO_USB_OTG_HS_AHB_BURST_ADDR A:0x78d9090
y.create.l HWIO_USB_OTG_HS_XTOR_STS_ADDR A:0x78d9094
y.create.l HWIO_USB_OTG_HS_AHB_MODE_ADDR A:0x78d9098
y.create.l HWIO_USB_OTG_HS_GEN_CONFIG_ADDR A:0x78d909c
y.create.l HWIO_USB_OTG_HS_GEN_CONFIG_2_ADDR A:0x78d90a0
y.create.l HWIO_USB_OTG_HS_CAPLENGTH_ADDR A:0x78d9100
y.create.l HWIO_USB_OTG_HS_HCSPARAMS_ADDR A:0x78d9104
y.create.l HWIO_USB_OTG_HS_HCCPARAMS_ADDR A:0x78d9108
y.create.l HWIO_USB_OTG_HS_DCIVERSION_ADDR A:0x78d9120
y.create.l HWIO_USB_OTG_HS_DCCPARAMS_ADDR A:0x78d9124
y.create.l HWIO_USB_OTG_HS_USBCMD_ADDR A:0x78d9140
y.create.l HWIO_USB_OTG_HS_USBSTS_ADDR A:0x78d9144
y.create.l HWIO_USB_OTG_HS_USBINTR_ADDR A:0x78d9148
y.create.l HWIO_USB_OTG_HS_FRINDEX_ADDR A:0x78d914c
y.create.l HWIO_USB_OTG_HS_PERIODICLISTBASE_ADDR A:0x78d9154
y.create.l HWIO_USB_OTG_HS_DEVICEADDR_ADDR A:0x78d9154
y.create.l HWIO_USB_OTG_HS_ASYNCLISTADDR_ADDR A:0x78d9158
y.create.l HWIO_USB_OTG_HS_ENDPOINTLISTADDR_ADDR A:0x78d9158
y.create.l HWIO_USB_OTG_HS_TTCTRL_ADDR A:0x78d915c
y.create.l HWIO_USB_OTG_HS_BURSTSIZE_ADDR A:0x78d9160
y.create.l HWIO_USB_OTG_HS_TXFILLTUNING_ADDR A:0x78d9164
y.create.l HWIO_USB_OTG_HS_ULPI_VIEWPORT_ADDR A:0x78d9170
y.create.l HWIO_USB_OTG_HS_ENDPTNAK_ADDR A:0x78d9178
y.create.l HWIO_USB_OTG_HS_ENDPTNAKEN_ADDR A:0x78d917c
y.create.l HWIO_USB_OTG_HS_PORTSC_ADDR A:0x78d9184
y.create.l HWIO_USB_OTG_HS_OTGSC_ADDR A:0x78d91a4
y.create.l HWIO_USB_OTG_HS_USBMODE_ADDR A:0x78d91a8
y.create.l HWIO_USB_OTG_HS_ENDPTSETUPSTAT_ADDR A:0x78d91ac
y.create.l HWIO_USB_OTG_HS_ENDPTPRIME_ADDR A:0x78d91b0
y.create.l HWIO_USB_OTG_HS_ENDPTFLUSH_ADDR A:0x78d91b4
y.create.l HWIO_USB_OTG_HS_ENDPTSTAT_ADDR A:0x78d91b8
y.create.l HWIO_USB_OTG_HS_ENDPTCOMPLETE_ADDR A:0x78d91bc
y.create.l HWIO_USB_OTG_HS_ENDPTCTRL0_ADDR A:0x78d91c0
y.create.l HWIO_USB_OTG_HS_ENDPTCTRL1_ADDR A:0x78d91c4
y.create.l HWIO_USB_OTG_HS_ENDPTCTRL2_ADDR A:0x78d91c8
y.create.l HWIO_USB_OTG_HS_ENDPTCTRL3_ADDR A:0x78d91cc
y.create.l HWIO_USB_OTG_HS_ENDPTCTRL4_ADDR A:0x78d91d0
y.create.l HWIO_USB_OTG_HS_ENDPTCTRL5_ADDR A:0x78d91d4
y.create.l HWIO_USB_OTG_HS_ENDPTCTRL6_ADDR A:0x78d91d8
y.create.l HWIO_USB_OTG_HS_ENDPTCTRL7_ADDR A:0x78d91dc
y.create.l HWIO_USB_OTG_HS_ENDPTCTRL8_ADDR A:0x78d91e0
y.create.l HWIO_USB_OTG_HS_ENDPTCTRL9_ADDR A:0x78d91e4
y.create.l HWIO_USB_OTG_HS_ENDPTCTRL10_ADDR A:0x78d91e8
y.create.l HWIO_USB_OTG_HS_ENDPT_PIPE_ID1_ADDR A:0x78d9200
y.create.l HWIO_USB_OTG_HS_ENDPT_PIPE_ID2_ADDR A:0x78d9204
y.create.l HWIO_USB_OTG_HS_ENDPT_PIPE_ID3_ADDR A:0x78d9208
y.create.l HWIO_USB_OTG_HS_ENDPT_PIPE_ID4_ADDR A:0x78d920c
y.create.l HWIO_USB_OTG_HS_ENDPT_PIPE_ID5_ADDR A:0x78d9210
y.create.l HWIO_USB_OTG_HS_ENDPT_PIPE_ID6_ADDR A:0x78d9214
y.create.l HWIO_USB_OTG_HS_ENDPT_PIPE_ID7_ADDR A:0x78d9218
y.create.l HWIO_USB_OTG_HS_ENDPT_PIPE_ID8_ADDR A:0x78d921c
y.create.l HWIO_USB_OTG_HS_ENDPT_PIPE_ID9_ADDR A:0x78d9220
y.create.l HWIO_USB_OTG_HS_ENDPT_PIPE_ID10_ADDR A:0x78d9224
y.create.l HWIO_USB_OTG_HS_PHY_CTRL_ADDR A:0x78d9240
y.create.l HWIO_USB_OTG_HS_GENERIC1_ADDR A:0x78d9244
y.create.l HWIO_USB_OTG_HS_GENERIC2_ADDR A:0x78d9248
y.create.l HWIO_USB_OTG_HS_L1_EP_CTRL_ADDR A:0x78d9250
y.create.l HWIO_USB_OTG_HS_L1_CONFIG_ADDR A:0x78d9254
y.create.l HWIO_USB_OTG_HS_LPM_DEBUG_1_ADDR A:0x78d9258
y.create.l HWIO_USB_OTG_HS_LPM_DEBUG_2_ADDR A:0x78d925c
y.create.l HWIO_USB_OTG_HS_LPM_ATTRIBUTES_ADDR A:0x78d9260
y.create.l HWIO_USB_OTG_HS_LPM_TIMERS_ADDR A:0x78d9264
y.create.l HWIO_USB_OTG_HS_HW_VER_ADDR A:0x78d9270
y.create.l HWIO_USB_OTG_HS_TEST_BUS_ADDR A:0x78d9274
y.create.l HWIO_USB_OTG_HS_PHY_SEC_CTRL_ADDR A:0x78d9278
y.create.l HWIO_USB_OTG_HS_BTO_TIME_HS_ADDR A:0x78d9340
y.create.l HWIO_USB_OTG_HS_BTO_TIME_FS_LS_ADDR A:0x78d9344
y.create.l HWIO_USB_OTG_HS_QSB_VALUES_ADDR A:0x78d9348
y.create.l HWIO_USB_OTG_HS_DMA_STUCK_TIMER_ADDR A:0x78d9350
y.create.l HWIO_USB_OTG_HS_SM_OVERRIDE_ADDR A:0x78d9360
y.create.l HWIO_USB_OTG_HS_SM_FENCE_ADDR A:0x78d9364
y.create.l HWIO_USB_OTG_HS_SM_STATE_ADDR A:0x78d9368
y.create.l HWIO_USB_OTG_HS_SPARE_REG_ADDR A:0x78d936c
y.create.l HWIO_USB_OTG_HS_APF_DBG_CNT_CTRL_ADDR A:0x78d9370
y.create.l HWIO_USB_OTG_HS_APF_DBG_CNT_VAL_ADDR A:0x78d9374
y.create.l HWIO_USB_OTG_HS_APF_DBG_CNT_TRESHOLD_ADDR A:0x78d9378
y.create.l HWIO_USB_OTG_HS_APF_CTRL_ADDR A:0x78d9380
y.create.l HWIO_USB_OTG_HS_APF_DBG_ADDR A:0x78d9384
y.create.l HWIO_USB_OTG_HS_APF_AXI_OVERRIDE_ADDR A:0x78d9388
y.create.l HWIO_USB_OTG_HS_APF_ERR_ADDR_ADDR A:0x78d9390
y.create.l HWIO_USB_OTG_HS_APF_ERR_CTRL_ADDR A:0x78d9394
y.create.l HWIO_USB_OTG_HS_APF_ERR_DATA_LSB_ADDR A:0x78d9398
y.create.l HWIO_USB_OTG_HS_APF_ERR_DATA_MSB_ADDR A:0x78d939c
y.create.l HWIO_USB_OTG_HS_APF_STS_ADDR A:0x78d93a0
y.create.l HWIO_USB_OTG_HS_APF_STS_CLR_ADDR A:0x78d93a4
y.create.l HWIO_USB_OTG_HS_APF_TIMEOUT_ADDR A:0x78d93a8
y.create.l HWIO_USB_OTG_HS_USBSTS_2_ADDR A:0x78d93c0
y.create.l HWIO_USB_OTG_HS_USBINTR_2_ADDR A:0x78d93c4
y.create.l HWIO_USB_OTG_HS_AHB_STALL_TIMEOUT_ADDR A:0x78d93c8
y.create.l HWIO_USB_OTG_HS_AHB_STALL_ADDR_ADDR A:0x78d93cc
y.create.l HWIO_BAM_CTRL_ADDR A:0x78c4000
y.create.l HWIO_BAM_TIMER_ADDR A:0x78c4040
y.create.l HWIO_BAM_TIMER_CTRL_ADDR A:0x78c4044
y.create.l HWIO_BAM_DESC_CNT_TRSHLD_ADDR A:0x78c4008
y.create.l HWIO_BAM_IRQ_STTS_ADDR A:0x78c4014
y.create.l HWIO_BAM_IRQ_CLR_ADDR A:0x78c4018
y.create.l HWIO_BAM_IRQ_EN_ADDR A:0x78c401c
y.create.l HWIO_BAM_CNFG_BITS_ADDR A:0x78c407c
y.create.l HWIO_BAM_CNFG_BITS_2_ADDR A:0x78c4084
y.create.l HWIO_BAM_REVISION_ADDR A:0x78c5000
y.create.l HWIO_BAM_SW_VERSION_ADDR A:0x78c5004
y.create.l HWIO_BAM_NUM_PIPES_ADDR A:0x78c5008
y.create.l HWIO_BAM_TEST_BUS_SEL_ADDR A:0x78c5010
y.create.l HWIO_BAM_TEST_BUS_REG_ADDR A:0x78c5014
y.create.l HWIO_BAM_AHB_MASTER_ERR_CTRLS_ADDR A:0x78c5024
y.create.l HWIO_BAM_AHB_MASTER_ERR_ADDR_ADDR A:0x78c5028
y.create.l HWIO_BAM_AHB_MASTER_ERR_DATA_ADDR A:0x78c502c
y.create.l HWIO_BAM_AHB_MASTER_ERR_ADDR_LSB_ADDR A:0x78c5100
y.create.l HWIO_BAM_AHB_MASTER_ERR_ADDR_MSB_ADDR A:0x78c5104
y.create.l HWIO_BAM_TRUST_REG_ADDR A:0x78c6000
y.create.l HWIO_BAM_P_TRUST_REG0_ADDR A:0x78c6020
y.create.l HWIO_BAM_P_TRUST_REG1_ADDR A:0x78c6024
y.create.l HWIO_BAM_IRQ_SRCS_EE0_ADDR A:0x78c7000
y.create.l HWIO_BAM_IRQ_SRCS_EE1_ADDR A:0x78c8000
y.create.l HWIO_BAM_IRQ_SRCS_EE2_ADDR A:0x78c9000
y.create.l HWIO_BAM_IRQ_SRCS_EE3_ADDR A:0x78ca000
y.create.l HWIO_BAM_IRQ_SRCS_EE4_ADDR A:0x78cb000
y.create.l HWIO_BAM_IRQ_SRCS_EE5_ADDR A:0x78cc000
y.create.l HWIO_BAM_IRQ_SRCS_EE6_ADDR A:0x78cd000
y.create.l HWIO_BAM_IRQ_SRCS_EE7_ADDR A:0x78ce000
y.create.l HWIO_BAM_IRQ_SRCS_MSK_EE0_ADDR A:0x78c7004
y.create.l HWIO_BAM_IRQ_SRCS_MSK_EE1_ADDR A:0x78c8004
y.create.l HWIO_BAM_IRQ_SRCS_MSK_EE2_ADDR A:0x78c9004
y.create.l HWIO_BAM_IRQ_SRCS_MSK_EE3_ADDR A:0x78ca004
y.create.l HWIO_BAM_IRQ_SRCS_MSK_EE4_ADDR A:0x78cb004
y.create.l HWIO_BAM_IRQ_SRCS_MSK_EE5_ADDR A:0x78cc004
y.create.l HWIO_BAM_IRQ_SRCS_MSK_EE6_ADDR A:0x78cd004
y.create.l HWIO_BAM_IRQ_SRCS_MSK_EE7_ADDR A:0x78ce004
y.create.l HWIO_BAM_IRQ_SRCS_UNMASKED_EE0_ADDR A:0x78c7008
y.create.l HWIO_BAM_IRQ_SRCS_UNMASKED_EE1_ADDR A:0x78c8008
y.create.l HWIO_BAM_IRQ_SRCS_UNMASKED_EE2_ADDR A:0x78c9008
y.create.l HWIO_BAM_IRQ_SRCS_UNMASKED_EE3_ADDR A:0x78ca008
y.create.l HWIO_BAM_IRQ_SRCS_UNMASKED_EE4_ADDR A:0x78cb008
y.create.l HWIO_BAM_IRQ_SRCS_UNMASKED_EE5_ADDR A:0x78cc008
y.create.l HWIO_BAM_IRQ_SRCS_UNMASKED_EE6_ADDR A:0x78cd008
y.create.l HWIO_BAM_IRQ_SRCS_UNMASKED_EE7_ADDR A:0x78ce008
y.create.l HWIO_BAM_PIPE_ATTR_EE0_ADDR A:0x78c700c
y.create.l HWIO_BAM_PIPE_ATTR_EE1_ADDR A:0x78c800c
y.create.l HWIO_BAM_PIPE_ATTR_EE2_ADDR A:0x78c900c
y.create.l HWIO_BAM_PIPE_ATTR_EE3_ADDR A:0x78ca00c
y.create.l HWIO_BAM_PIPE_ATTR_EE4_ADDR A:0x78cb00c
y.create.l HWIO_BAM_PIPE_ATTR_EE5_ADDR A:0x78cc00c
y.create.l HWIO_BAM_PIPE_ATTR_EE6_ADDR A:0x78cd00c
y.create.l HWIO_BAM_PIPE_ATTR_EE7_ADDR A:0x78ce00c
y.create.l HWIO_BAM_IRQ_SRCS_ADDR A:0x78c7010
y.create.l HWIO_BAM_IRQ_SRCS_MSK_ADDR A:0x78c7014
y.create.l HWIO_BAM_IRQ_SRCS_UNMASKED_ADDR A:0x78c7018
y.create.l HWIO_BAM_P_CTRL0_ADDR A:0x78d7000
y.create.l HWIO_BAM_P_CTRL1_ADDR A:0x78d8000
y.create.l HWIO_BAM_P_RST0_ADDR A:0x78d7004
y.create.l HWIO_BAM_P_RST1_ADDR A:0x78d8004
y.create.l HWIO_BAM_P_HALT0_ADDR A:0x78d7008
y.create.l HWIO_BAM_P_HALT1_ADDR A:0x78d8008
y.create.l HWIO_BAM_P_IRQ_STTS0_ADDR A:0x78d7010
y.create.l HWIO_BAM_P_IRQ_STTS1_ADDR A:0x78d8010
y.create.l HWIO_BAM_P_IRQ_CLR0_ADDR A:0x78d7014
y.create.l HWIO_BAM_P_IRQ_CLR1_ADDR A:0x78d8014
y.create.l HWIO_BAM_P_IRQ_EN0_ADDR A:0x78d7018
y.create.l HWIO_BAM_P_IRQ_EN1_ADDR A:0x78d8018
y.create.l HWIO_BAM_P_TIMER0_ADDR A:0x78d701c
y.create.l HWIO_BAM_P_TIMER1_ADDR A:0x78d801c
y.create.l HWIO_BAM_P_TIMER_CTRL0_ADDR A:0x78d7020
y.create.l HWIO_BAM_P_TIMER_CTRL1_ADDR A:0x78d8020
y.create.l HWIO_BAM_P_PRDCR_SDBND0_ADDR A:0x78d7024
y.create.l HWIO_BAM_P_PRDCR_SDBND1_ADDR A:0x78d8024
y.create.l HWIO_BAM_P_CNSMR_SDBND0_ADDR A:0x78d7028
y.create.l HWIO_BAM_P_CNSMR_SDBND1_ADDR A:0x78d8028
y.create.l HWIO_BAM_P_SW_OFSTS0_ADDR A:0x78d7800
y.create.l HWIO_BAM_P_SW_OFSTS1_ADDR A:0x78d8800
y.create.l HWIO_BAM_P_AU_PSM_CNTXT_1_0_ADDR A:0x78d7804
y.create.l HWIO_BAM_P_AU_PSM_CNTXT_1_1_ADDR A:0x78d8804
y.create.l HWIO_BAM_P_PSM_CNTXT_2_0_ADDR A:0x78d7808
y.create.l HWIO_BAM_P_PSM_CNTXT_2_1_ADDR A:0x78d8808
y.create.l HWIO_BAM_P_PSM_CNTXT_3_0_ADDR A:0x78d780c
y.create.l HWIO_BAM_P_PSM_CNTXT_3_1_ADDR A:0x78d880c
y.create.l HWIO_BAM_P_PSM_CNTXT_4_0_ADDR A:0x78d7810
y.create.l HWIO_BAM_P_PSM_CNTXT_4_1_ADDR A:0x78d8810
y.create.l HWIO_BAM_P_PSM_CNTXT_5_0_ADDR A:0x78d7814
y.create.l HWIO_BAM_P_PSM_CNTXT_5_1_ADDR A:0x78d8814
y.create.l HWIO_BAM_P_EVNT_REG0_ADDR A:0x78d7818
y.create.l HWIO_BAM_P_EVNT_REG1_ADDR A:0x78d8818
y.create.l HWIO_BAM_P_DESC_FIFO_ADDR0_ADDR A:0x78d781c
y.create.l HWIO_BAM_P_DESC_FIFO_ADDR1_ADDR A:0x78d881c
y.create.l HWIO_BAM_P_FIFO_SIZES0_ADDR A:0x78d7820
y.create.l HWIO_BAM_P_FIFO_SIZES1_ADDR A:0x78d8820
y.create.l HWIO_BAM_P_DATA_FIFO_ADDR0_ADDR A:0x78d7824
y.create.l HWIO_BAM_P_DATA_FIFO_ADDR1_ADDR A:0x78d8824
y.create.l HWIO_BAM_P_EVNT_GEN_TRSHLD0_ADDR A:0x78d7828
y.create.l HWIO_BAM_P_EVNT_GEN_TRSHLD1_ADDR A:0x78d8828
y.create.l HWIO_BAM_P_EVNT_DEST_ADDR0_ADDR A:0x78d782c
y.create.l HWIO_BAM_P_EVNT_DEST_ADDR1_ADDR A:0x78d882c
y.create.l HWIO_BAM_P_DF_CNTXT_0_ADDR A:0x78d7830
y.create.l HWIO_BAM_P_DF_CNTXT_1_ADDR A:0x78d8830
y.create.l HWIO_BAM_P_RETR_CNTXT_0_ADDR A:0x78d7834
y.create.l HWIO_BAM_P_RETR_CNTXT_1_ADDR A:0x78d8834
y.create.l HWIO_BAM_P_SI_CNTXT_0_ADDR A:0x78d7838
y.create.l HWIO_BAM_P_SI_CNTXT_1_ADDR A:0x78d8838
y.create.l HWIO_BAM_P_PSM_CNTXT_3_LSB0_ADDR A:0x78d7900
y.create.l HWIO_BAM_P_PSM_CNTXT_3_LSB1_ADDR A:0x78d8900
y.create.l HWIO_BAM_P_PSM_CNTXT_3_MSB0_ADDR A:0x78d7904
y.create.l HWIO_BAM_P_PSM_CNTXT_3_MSB1_ADDR A:0x78d8904
y.create.l HWIO_BAM_P_DESC_FIFO_ADDR_LSB0_ADDR A:0x78d7910
y.create.l HWIO_BAM_P_DESC_FIFO_ADDR_LSB1_ADDR A:0x78d8910
y.create.l HWIO_BAM_P_DESC_FIFO_ADDR_MSB0_ADDR A:0x78d7914
y.create.l HWIO_BAM_P_DESC_FIFO_ADDR_MSB1_ADDR A:0x78d8914
y.create.l HWIO_BAM_P_DATA_FIFO_ADDR_LSB0_ADDR A:0x78d7920
y.create.l HWIO_BAM_P_DATA_FIFO_ADDR_LSB1_ADDR A:0x78d8920
y.create.l HWIO_BAM_P_DATA_FIFO_ADDR_MSB0_ADDR A:0x78d7924
y.create.l HWIO_BAM_P_DATA_FIFO_ADDR_MSB1_ADDR A:0x78d8924
y.create.l HWIO_BAM_P_EVNT_DEST_ADDR_LSB0_ADDR A:0x78d7930
y.create.l HWIO_BAM_P_EVNT_DEST_ADDR_LSB1_ADDR A:0x78d8930
y.create.l HWIO_BAM_P_EVNT_DEST_ADDR_MSB0_ADDR A:0x78d7934
y.create.l HWIO_BAM_P_EVNT_DEST_ADDR_MSB1_ADDR A:0x78d8934
y.create.l HWIO_XPU_CFG_PCNOC_CFG_XPU_SCR_ADDR A:0x2e000
y.create.l HWIO_XPU_CFG_PCNOC_CFG_XPU_SWDR_ADDR A:0x2e004
y.create.l HWIO_XPU_CFG_PCNOC_CFG_XPU_PRTN_RACR_SSHADOW_ADDR A:0x2e008
y.create.l HWIO_XPU_CFG_PCNOC_CFG_XPU_PRTN_WACR_SSHADOW_ADDR A:0x2e00c
y.create.l HWIO_XPU_CFG_PCNOC_CFG_XPU_PRTN_START_SSHADOW0_ADDR A:0x2e010
y.create.l HWIO_XPU_CFG_PCNOC_CFG_XPU_PRTN_END_SSHADOW0_ADDR A:0x2e018
y.create.l HWIO_XPU_CFG_PCNOC_CFG_XPU_SEAR0_ADDR A:0x2e040
y.create.l HWIO_XPU_CFG_PCNOC_CFG_XPU_SESR_ADDR A:0x2e048
y.create.l HWIO_XPU_CFG_PCNOC_CFG_XPU_SESRRESTORE_ADDR A:0x2e04c
y.create.l HWIO_XPU_CFG_PCNOC_CFG_XPU_SESYNR0_ADDR A:0x2e050
y.create.l HWIO_XPU_CFG_PCNOC_CFG_XPU_SESYNR1_ADDR A:0x2e054
y.create.l HWIO_XPU_CFG_PCNOC_CFG_XPU_SESYNR2_ADDR A:0x2e058
y.create.l HWIO_XPU_CFG_PCNOC_CFG_XPU_MCR_ADDR A:0x2e100
y.create.l HWIO_XPU_CFG_PCNOC_CFG_XPU_MEAR0_ADDR A:0x2e140
y.create.l HWIO_XPU_CFG_PCNOC_CFG_XPU_MESR_ADDR A:0x2e148
y.create.l HWIO_XPU_CFG_PCNOC_CFG_XPU_MESRRESTORE_ADDR A:0x2e14c
y.create.l HWIO_XPU_CFG_PCNOC_CFG_XPU_MESYNR0_ADDR A:0x2e150
y.create.l HWIO_XPU_CFG_PCNOC_CFG_XPU_MESYNR1_ADDR A:0x2e154
y.create.l HWIO_XPU_CFG_PCNOC_CFG_XPU_MESYNR2_ADDR A:0x2e158
y.create.l HWIO_XPU_CFG_PCNOC_CFG_XPU_CR_ADDR A:0x2e080
y.create.l HWIO_XPU_CFG_PCNOC_CFG_XPU_PRTN_RACR_SHADOW_ADDR A:0x2e088
y.create.l HWIO_XPU_CFG_PCNOC_CFG_XPU_PRTN_WACR_SHADOW_ADDR A:0x2e08c
y.create.l HWIO_XPU_CFG_PCNOC_CFG_XPU_PRTN_START_SHADOW0_ADDR A:0x2e090
y.create.l HWIO_XPU_CFG_PCNOC_CFG_XPU_PRTN_END_SHADOW0_ADDR A:0x2e098
y.create.l HWIO_XPU_CFG_PCNOC_CFG_XPU_RPU_ACR0_ADDR A:0x2e0a0
y.create.l HWIO_XPU_CFG_PCNOC_CFG_XPU_EAR0_ADDR A:0x2e0c0
y.create.l HWIO_XPU_CFG_PCNOC_CFG_XPU_ESR_ADDR A:0x2e0c8
y.create.l HWIO_XPU_CFG_PCNOC_CFG_XPU_ESRRESTORE_ADDR A:0x2e0cc
y.create.l HWIO_XPU_CFG_PCNOC_CFG_XPU_ESYNR0_ADDR A:0x2e0d0
y.create.l HWIO_XPU_CFG_PCNOC_CFG_XPU_ESYNR1_ADDR A:0x2e0d4
y.create.l HWIO_XPU_CFG_PCNOC_CFG_XPU_ESYNR2_ADDR A:0x2e0d8
y.create.l HWIO_XPU_CFG_PCNOC_CFG_XPU_UMR_RACR_ADDR A:0x2e0e0
y.create.l HWIO_XPU_CFG_PCNOC_CFG_XPU_UMR_WACR_ADDR A:0x2e0e4
y.create.l HWIO_XPU_CFG_PCNOC_CFG_XPU_UMR_CNTL_ADDR A:0x2e0f0
y.create.l HWIO_XPU_CFG_PCNOC_CFG_XPU_IDR0_ADDR A:0x2e074
y.create.l HWIO_XPU_CFG_PCNOC_CFG_XPU_IDR1_ADDR A:0x2e078
y.create.l HWIO_XPU_CFG_PCNOC_CFG_XPU_REV_ADDR A:0x2e07c
y.create.l HWIO_XPU_CFG_PCNOC_CFG_XPU_PRT0_RACR0_ADDR A:0x2e200
y.create.l HWIO_XPU_CFG_PCNOC_CFG_XPU_PRT1_RACR0_ADDR A:0x2e280
y.create.l HWIO_XPU_CFG_PCNOC_CFG_XPU_PRT2_RACR0_ADDR A:0x2e300
y.create.l HWIO_XPU_CFG_PCNOC_CFG_XPU_PRT3_RACR0_ADDR A:0x2e380
y.create.l HWIO_XPU_CFG_PCNOC_CFG_XPU_PRT0_WACR0_ADDR A:0x2e220
y.create.l HWIO_XPU_CFG_PCNOC_CFG_XPU_PRT1_WACR0_ADDR A:0x2e2a0
y.create.l HWIO_XPU_CFG_PCNOC_CFG_XPU_PRT2_WACR0_ADDR A:0x2e320
y.create.l HWIO_XPU_CFG_PCNOC_CFG_XPU_PRT3_WACR0_ADDR A:0x2e3a0
y.create.l HWIO_XPU_CFG_PCNOC_CFG_XPU_PRT0_START0_ADDR A:0x2e240
y.create.l HWIO_XPU_CFG_PCNOC_CFG_XPU_PRT1_START0_ADDR A:0x2e2c0
y.create.l HWIO_XPU_CFG_PCNOC_CFG_XPU_PRT2_START0_ADDR A:0x2e340
y.create.l HWIO_XPU_CFG_PCNOC_CFG_XPU_PRT3_START0_ADDR A:0x2e3c0
y.create.l HWIO_XPU_CFG_PCNOC_CFG_XPU_PRT0_END0_ADDR A:0x2e248
y.create.l HWIO_XPU_CFG_PCNOC_CFG_XPU_PRT1_END0_ADDR A:0x2e2c8
y.create.l HWIO_XPU_CFG_PCNOC_CFG_XPU_PRT2_END0_ADDR A:0x2e348
y.create.l HWIO_XPU_CFG_PCNOC_CFG_XPU_PRT3_END0_ADDR A:0x2e3c8
y.create.l HWIO_XPU_CFG_PCNOC_CFG_XPU_PRT0_SCR_ADDR A:0x2e250
y.create.l HWIO_XPU_CFG_PCNOC_CFG_XPU_PRT1_SCR_ADDR A:0x2e2d0
y.create.l HWIO_XPU_CFG_PCNOC_CFG_XPU_PRT2_SCR_ADDR A:0x2e350
y.create.l HWIO_XPU_CFG_PCNOC_CFG_XPU_PRT3_SCR_ADDR A:0x2e3d0
y.create.l HWIO_XPU_CFG_PCNOC_CFG_XPU_PRT0_MCR_ADDR A:0x2e254
y.create.l HWIO_XPU_CFG_PCNOC_CFG_XPU_PRT1_MCR_ADDR A:0x2e2d4
y.create.l HWIO_XPU_CFG_PCNOC_CFG_XPU_PRT2_MCR_ADDR A:0x2e354
y.create.l HWIO_XPU_CFG_PCNOC_CFG_XPU_PRT3_MCR_ADDR A:0x2e3d4
y.create.l HWIO_XPU_CFG_PCNOC_CFG_XPU_PRT0_CNTL0_ADDR A:0x2e258
y.create.l HWIO_XPU_CFG_PCNOC_CFG_XPU_PRT1_CNTL0_ADDR A:0x2e2d8
y.create.l HWIO_XPU_CFG_PCNOC_CFG_XPU_PRT2_CNTL0_ADDR A:0x2e358
y.create.l HWIO_XPU_CFG_PCNOC_CFG_XPU_PRT3_CNTL0_ADDR A:0x2e3d8
y.create.l HWIO_XPU_CFG_PCNOC_CFG_XPU_PRT0_CNTL1_ADDR A:0x2e25c
y.create.l HWIO_XPU_CFG_PCNOC_CFG_XPU_PRT1_CNTL1_ADDR A:0x2e2dc
y.create.l HWIO_XPU_CFG_PCNOC_CFG_XPU_PRT2_CNTL1_ADDR A:0x2e35c
y.create.l HWIO_XPU_CFG_PCNOC_CFG_XPU_PRT3_CNTL1_ADDR A:0x2e3dc
y.create.l HWIO_XPU_CFG_PRNG_CFG_XPU_SCR_ADDR A:0x2f000
y.create.l HWIO_XPU_CFG_PRNG_CFG_XPU_SWDR_ADDR A:0x2f004
y.create.l HWIO_XPU_CFG_PRNG_CFG_XPU_SEAR0_ADDR A:0x2f040
y.create.l HWIO_XPU_CFG_PRNG_CFG_XPU_SESR_ADDR A:0x2f048
y.create.l HWIO_XPU_CFG_PRNG_CFG_XPU_SESRRESTORE_ADDR A:0x2f04c
y.create.l HWIO_XPU_CFG_PRNG_CFG_XPU_SESYNR0_ADDR A:0x2f050
y.create.l HWIO_XPU_CFG_PRNG_CFG_XPU_SESYNR1_ADDR A:0x2f054
y.create.l HWIO_XPU_CFG_PRNG_CFG_XPU_SESYNR2_ADDR A:0x2f058
y.create.l HWIO_XPU_CFG_PRNG_CFG_XPU_MCR_ADDR A:0x2f100
y.create.l HWIO_XPU_CFG_PRNG_CFG_XPU_MEAR0_ADDR A:0x2f140
y.create.l HWIO_XPU_CFG_PRNG_CFG_XPU_MESR_ADDR A:0x2f148
y.create.l HWIO_XPU_CFG_PRNG_CFG_XPU_MESRRESTORE_ADDR A:0x2f14c
y.create.l HWIO_XPU_CFG_PRNG_CFG_XPU_MESYNR0_ADDR A:0x2f150
y.create.l HWIO_XPU_CFG_PRNG_CFG_XPU_MESYNR1_ADDR A:0x2f154
y.create.l HWIO_XPU_CFG_PRNG_CFG_XPU_MESYNR2_ADDR A:0x2f158
y.create.l HWIO_XPU_CFG_PRNG_CFG_XPU_CR_ADDR A:0x2f080
y.create.l HWIO_XPU_CFG_PRNG_CFG_XPU_RPU_ACR0_ADDR A:0x2f0a0
y.create.l HWIO_XPU_CFG_PRNG_CFG_XPU_EAR0_ADDR A:0x2f0c0
y.create.l HWIO_XPU_CFG_PRNG_CFG_XPU_ESR_ADDR A:0x2f0c8
y.create.l HWIO_XPU_CFG_PRNG_CFG_XPU_ESRRESTORE_ADDR A:0x2f0cc
y.create.l HWIO_XPU_CFG_PRNG_CFG_XPU_ESYNR0_ADDR A:0x2f0d0
y.create.l HWIO_XPU_CFG_PRNG_CFG_XPU_ESYNR1_ADDR A:0x2f0d4
y.create.l HWIO_XPU_CFG_PRNG_CFG_XPU_ESYNR2_ADDR A:0x2f0d8
y.create.l HWIO_XPU_CFG_PRNG_CFG_XPU_IDR0_ADDR A:0x2f074
y.create.l HWIO_XPU_CFG_PRNG_CFG_XPU_IDR1_ADDR A:0x2f078
y.create.l HWIO_XPU_CFG_PRNG_CFG_XPU_REV_ADDR A:0x2f07c
y.create.l HWIO_XPU_CFG_PRNG_CFG_XPU_RG0_RACR0_ADDR A:0x2f200
y.create.l HWIO_XPU_CFG_PRNG_CFG_XPU_RG0_WACR0_ADDR A:0x2f220
y.create.l HWIO_XPU_CFG_PRNG_CFG_XPU_RG0_SCR_ADDR A:0x2f250
y.create.l HWIO_XPU_CFG_PRNG_CFG_XPU_RG0_MCR_ADDR A:0x2f254
y.create.l HWIO_XPU_CFG_RPM_CFG_XPU_SCR_ADDR A:0x33000
y.create.l HWIO_XPU_CFG_RPM_CFG_XPU_SWDR_ADDR A:0x33004
y.create.l HWIO_XPU_CFG_RPM_CFG_XPU_PRTN_RACR_SSHADOW_ADDR A:0x33008
y.create.l HWIO_XPU_CFG_RPM_CFG_XPU_PRTN_WACR_SSHADOW_ADDR A:0x3300c
y.create.l HWIO_XPU_CFG_RPM_CFG_XPU_PRTN_START_SSHADOW0_ADDR A:0x33010
y.create.l HWIO_XPU_CFG_RPM_CFG_XPU_PRTN_END_SSHADOW0_ADDR A:0x33018
y.create.l HWIO_XPU_CFG_RPM_CFG_XPU_SEAR0_ADDR A:0x33040
y.create.l HWIO_XPU_CFG_RPM_CFG_XPU_SESR_ADDR A:0x33048
y.create.l HWIO_XPU_CFG_RPM_CFG_XPU_SESRRESTORE_ADDR A:0x3304c
y.create.l HWIO_XPU_CFG_RPM_CFG_XPU_SESYNR0_ADDR A:0x33050
y.create.l HWIO_XPU_CFG_RPM_CFG_XPU_SESYNR1_ADDR A:0x33054
y.create.l HWIO_XPU_CFG_RPM_CFG_XPU_SESYNR2_ADDR A:0x33058
y.create.l HWIO_XPU_CFG_RPM_CFG_XPU_MCR_ADDR A:0x33100
y.create.l HWIO_XPU_CFG_RPM_CFG_XPU_MEAR0_ADDR A:0x33140
y.create.l HWIO_XPU_CFG_RPM_CFG_XPU_MESR_ADDR A:0x33148
y.create.l HWIO_XPU_CFG_RPM_CFG_XPU_MESRRESTORE_ADDR A:0x3314c
y.create.l HWIO_XPU_CFG_RPM_CFG_XPU_MESYNR0_ADDR A:0x33150
y.create.l HWIO_XPU_CFG_RPM_CFG_XPU_MESYNR1_ADDR A:0x33154
y.create.l HWIO_XPU_CFG_RPM_CFG_XPU_MESYNR2_ADDR A:0x33158
y.create.l HWIO_XPU_CFG_RPM_CFG_XPU_CR_ADDR A:0x33080
y.create.l HWIO_XPU_CFG_RPM_CFG_XPU_PRTN_RACR_SHADOW_ADDR A:0x33088
y.create.l HWIO_XPU_CFG_RPM_CFG_XPU_PRTN_WACR_SHADOW_ADDR A:0x3308c
y.create.l HWIO_XPU_CFG_RPM_CFG_XPU_PRTN_START_SHADOW0_ADDR A:0x33090
y.create.l HWIO_XPU_CFG_RPM_CFG_XPU_PRTN_END_SHADOW0_ADDR A:0x33098
y.create.l HWIO_XPU_CFG_RPM_CFG_XPU_RPU_ACR0_ADDR A:0x330a0
y.create.l HWIO_XPU_CFG_RPM_CFG_XPU_EAR0_ADDR A:0x330c0
y.create.l HWIO_XPU_CFG_RPM_CFG_XPU_ESR_ADDR A:0x330c8
y.create.l HWIO_XPU_CFG_RPM_CFG_XPU_ESRRESTORE_ADDR A:0x330cc
y.create.l HWIO_XPU_CFG_RPM_CFG_XPU_ESYNR0_ADDR A:0x330d0
y.create.l HWIO_XPU_CFG_RPM_CFG_XPU_ESYNR1_ADDR A:0x330d4
y.create.l HWIO_XPU_CFG_RPM_CFG_XPU_ESYNR2_ADDR A:0x330d8
y.create.l HWIO_XPU_CFG_RPM_CFG_XPU_UMR_RACR_ADDR A:0x330e0
y.create.l HWIO_XPU_CFG_RPM_CFG_XPU_UMR_WACR_ADDR A:0x330e4
y.create.l HWIO_XPU_CFG_RPM_CFG_XPU_UMR_CNTL_ADDR A:0x330f0
y.create.l HWIO_XPU_CFG_RPM_CFG_XPU_IDR0_ADDR A:0x33074
y.create.l HWIO_XPU_CFG_RPM_CFG_XPU_IDR1_ADDR A:0x33078
y.create.l HWIO_XPU_CFG_RPM_CFG_XPU_REV_ADDR A:0x3307c
y.create.l HWIO_XPU_CFG_RPM_CFG_XPU_PRT0_RACR0_ADDR A:0x33200
y.create.l HWIO_XPU_CFG_RPM_CFG_XPU_PRT1_RACR0_ADDR A:0x33280
y.create.l HWIO_XPU_CFG_RPM_CFG_XPU_PRT0_WACR0_ADDR A:0x33220
y.create.l HWIO_XPU_CFG_RPM_CFG_XPU_PRT1_WACR0_ADDR A:0x332a0
y.create.l HWIO_XPU_CFG_RPM_CFG_XPU_PRT0_START0_ADDR A:0x33240
y.create.l HWIO_XPU_CFG_RPM_CFG_XPU_PRT1_START0_ADDR A:0x332c0
y.create.l HWIO_XPU_CFG_RPM_CFG_XPU_PRT0_END0_ADDR A:0x33248
y.create.l HWIO_XPU_CFG_RPM_CFG_XPU_PRT1_END0_ADDR A:0x332c8
y.create.l HWIO_XPU_CFG_RPM_CFG_XPU_PRT0_SCR_ADDR A:0x33250
y.create.l HWIO_XPU_CFG_RPM_CFG_XPU_PRT1_SCR_ADDR A:0x332d0
y.create.l HWIO_XPU_CFG_RPM_CFG_XPU_PRT0_MCR_ADDR A:0x33254
y.create.l HWIO_XPU_CFG_RPM_CFG_XPU_PRT1_MCR_ADDR A:0x332d4
y.create.l HWIO_XPU_CFG_RPM_CFG_XPU_PRT0_CNTL0_ADDR A:0x33258
y.create.l HWIO_XPU_CFG_RPM_CFG_XPU_PRT1_CNTL0_ADDR A:0x332d8
y.create.l HWIO_XPU_CFG_RPM_CFG_XPU_PRT0_CNTL1_ADDR A:0x3325c
y.create.l HWIO_XPU_CFG_RPM_CFG_XPU_PRT1_CNTL1_ADDR A:0x332dc
y.create.done
