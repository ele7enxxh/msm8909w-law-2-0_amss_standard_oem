; --------------------------------------------------------------------------- #
; File Name :: cxm_trace.cmm
; Purpose   :: uses symbol info to print variables for parsing by 
;              cxm_log_parser.py
; --------------------------------------------------------------------------- #

; Copyright (c) 2013 Qualcomm Technologies Incorporated.
; All Rights Reserved.
; Qualcomm Confidential and Proprietary

; Export of this technology or software is regulated by the U.S. Government.
; Diversion contrary to U.S. law prohibited.

; All ideas, data and information contained in or disclosed by
; this document are confidential and proprietary information of
; Qualcomm Technologies Incorporated and all rights therein are expressly reserved.
; By accepting this material the recipient agrees that this material
; and the information contained therein are held in confidence and in
; trust and will not be used, copied, reproduced in whole or in part,
; nor its contents revealed in any manner to others without the express
; written permission of Qualcomm Technologies Incorporated.
; --------------------------------------------------------------------------- #

;==============================================================================
;
;                        EDIT HISTORY FOR MODULE
;
; This section contains comments describing changes made to the module.
; Notice that changes are listed in reverse chronological order.
;
; $Header: //commercial/MPSS.JO.2.0.c1.4/Main/modem_proc/mcs/cxm/tools/cxm_trace.cmm#1 $
;
; when       who    what, where, why
; --------   ---    -----------------------------------------------------------
; 10/03/14   btl    Add WCI2 trace
; 05/21/13   btl    Make script platform-independent
; 01/14/12   btl    Add cxm counters parsing
; 11/09/12   btl    initial rev
;
;==============================================================================


; dumps cxm_trace_buffer and parses, producing a log (text file) with a more
; readable output

; ENTRY details the program entry point with arguments.
; actions should be "all", "cxm", or "interleave"
ENTRY &dump_dir &actions
LOCAL &osreturn
LOCAL &file_name
LOCAL &version
LOCAL &py_args

Area.Reset
Area.Create CXM_PARSE 200. 1000.
Area.Select CXM_PARSE
Area CXM_PARSE

SETUP.Var %STD
SETUP.Var %h

IF "&actions"==""
(
  &actions="cxm"
)

IF "&actions"=="all"
(
  PRINT "Parsing cxm then wci2 trace"
  &py_args="-w yes"
)
ELSE IF "&actions"=="interleave"
(
  PRINT "Interleaving CXM and WCI2 traces"
  &py_args="-w interleave"
)
ELSE
(
  ; "&actions"=="cxm"
  PRINT "Parsing CXM trace only"
  &py_args="-w no"
)

; if processor still running, stop it
if run()
(
  break
)

; make sure symbols are loaded
IF (!Y.EXIST("cxm_trace_buffer"))
(
  print "Please load symbols before running script."
  enddo
)

; find the directory that the script is running in
&script_dir=os.ppd()
&wdir = os.pwd()

; check is a dir was specified
if "&dump_dir"==""
(
  &dump_dir="&script_dir"
)

; print log contents to dump_file
; create file name
&file_name="cxm_raw_log_dump.txt"

printer.open &dump_dir/&file_name
IF Y.EXIST("coex_state_info")
(
  wp.v.v %open.2 %r.2 coex_state_info
)
IF Y.EXIST("coex_wwan_state_info")
(
  wp.v.v %open.4 %r.2 coex_wwan_state_info
)
IF Y.EXIST("cxm_counters")
(
  wp.v.v %open.1 %h.off %d %i cxm_counters
)
IF Y.EXIST("cxm_fw_counters")
(
  wp.v.v %open.2 %r.2 cxm_fw_counters
)

wp.v.v %open.2 %r.2 cxm_trace_buffer
wp.v.v %open.2 %r.2 wci2_trace_buffer
printer.close

print "Logs collected"
print "Logs at &dump_dir/&file_name"

; call the parser to output .txt
print "Starting parser"

OS.area python --version

if os.return()!=0
(
  print "Error: Please check python is installed and in path"
  enddo
)

&version=2
print "python &script_dir/cxm_log_parser.py -f &dump_dir/&file_name -d &dump_dir -v &version &py_args"
OS.area python &script_dir/cxm_log_parser.py -f &dump_dir/&file_name -d &dump_dir -v &version &py_args

&osreturn=os.return()

if 0==&osreturn
(
  print "Completed successfully. Check &dump_dir for parsed log."
)
else if 1==&osreturn
(
  print "Error: Please check directory specified writeable and dump was generated correctly."
)
else if 2==&osreturn
(
  print "Error: dump file not found. Check dump directory writeable"
)
else if 3==&osreturn
(
  print "Error: problem writing output file. Check directory writeable"
)
else if 3==&osreturn
(
  print "Error: dump directory not valid"
)

enddo

