
AREA.SELECT A000
AREA.VIEW

LOCAL &reqNode &clientId &reqData &validFlag &validFlagE
LOCAL &numClients &numClientsPrint &index &indexPrint
LOCAL &latencyVote

PRINT ""
PRINT "ADSPPM Sleep Latency request list"
PRINT "---------------------------------"
&reqNode=V.VALUE(gAdsppmCoreCtx.AdsppmReqQArray[2].link.pNext)
&numClients=V.VALUE(gAdsppmCoreCtx.AdsppmReqQArray[2].nCnt)
&numClientsPrint=FORMAT.DECIMAL(0,&numClients)
PRINT "Number of clients = &numClientsPrint"
&index=1
&indexPrint=FORMAT.DECIMAL(0,&index)
WHILE &index<=&numClients
(
    &reqData=V.VALUE(((RMCtxType *)&reqNode).pRequestData)
    &clientId=FORMAT.DECIMAL(0,V.VALUE(((RMCtxType *)&reqNode).clientId))
    &validFlag=FORMAT.DECIMAL(0,V.VALUE(((RMCtxType *)&reqNode).validFlag))
    &validFlagE=FORMAT.DECIMAL(0,V.VALUE(((RMCtxType *)&reqNode).validFlag_Ext))
    IF &validFlag==1
    (
        PRINT "Client &indexPrint"
        PRINT "  reqNode        = (RMCtxType *)&reqNode"
        PRINT "  clientId       = &clientId"
        PRINT "  validFlag      = &validFlag"
        PRINT "  validFlag_Ext  = &validFlagE"
        &latencyVote=FORMAT.DECIMAL(0,V.VALUE(*((uint32 *)(&reqData))))
        PRINT "    latency (us) = &latencyVote"
    )
    ELSE
    (
        PRINT "Client &indexPrint [no request]"
    )
    &reqNode=V.VALUE(((coreUtils_Q_LinkType *)&reqNode).pNext)
    &index=&index+1
    &indexPrint=FORMAT.DECIMAL(0,&index)
)
