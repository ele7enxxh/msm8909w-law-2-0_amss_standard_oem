;============================================================================
;  Name:
;    GPIOINTERRUPTCONTROLLER.CMM
;
;  Description:
;    This script lets the user enter the processor platform. By doing this
;    it lets the user route to the specific GPIO interrupt controller platform 
;    script.
;
; Copyright (c) 2015 QUALCOMM Technologies Incorporated.  
; All Rights Reserved.
; Qualcomm Confidential and Proprietary
;----------------------------------------------------------------------------
;============================================================================
;
;                        EDIT HISTORY FOR MODULE
;
; when       who     what, where, why
; -------    ---     --------------------------------------------------------
; 10/2/2011  an      Created for querying GPIO InterruptController data.
;============================================================================;



;============================================================================
; Set up some defaults for some variables
;============================================================================
GLOBAL &GICDBASE &nIdx &PlatformSet &PlatformNum
GLOBAL &GICCBASE &L2VICBASE &Presult &nPrintRes &GPIOIntBase &GPIOIntDirNum &GPIOIntSumID &GPIOIntTargID &PinCfg &InOut
GLOBAL &DirCon0 &DirCon1 &DirCon2 &DirCon3 &DirCon4 &DirCon5 &DirCon6 &DirCon7 &MaxIRQ &DirCfgAddr &DirCfgAddr &StatusAddr &SumCfgAddr

&MaxIRQ=0xC8
;============================================================================
; Get the arguments passed in.
;============================================================================
ENTRY

&Presult=0
AREA.RESet
WINPOS 0. 0. 100% 100%
AREA.Create INTRMENU
AREA.view INTRMENU


on error gosub
(
  print "An Error has Occured"
  enddo (1==0)
)

DISPLAYMENU:
AREA.view INTRMENU
AREA.Select INTRMENU
;============================================================================
; don't proceed without user confirmation
;============================================================================
      
print "      "
print "************************************************************************"
print " "     
print "  T H E     G P I O     I N T E R R U P T C O N T R O L L E R     S C R I P T     "
print " "      
print "************************************************************************"      

if &Presult!=0
(
print " "
  GOSUB ERRORHNDLRMAIN &PlatformNum
print " "
print "************************************************************************" 
)
else if &Presult==0
(
)
&Presult=0
print " "
print " "
print " "
print "PLEASE CHOOSE FROM THE FOLLOWING OPTIONS TO SET THE GPIO INTERRUPT CONTROLLER" 
print "PLATFORM."
print " "
print " "
print "0. Exit the GPIO InterruptController script."
print "1. 8909 QDSP6 Modem"
print "2. 9x07 QDSP6 Modem"
print "3. 8937 QDSP6 Modem"
print " "
print " "
print "************************************************************************"    
print
print
print
print
&t32_cmm_stopped=1
enter &Platform
&t32_cmm_stopped=0
print
print
&PlatformNum=&Platform.
if &PlatformNum>0x3
(
  &Presult=1
  &PlatformSet=0
  &PlatformNum=0
  GOTO DISPLAYMENU
)
if (&PlatformNum==0)
(
  AREA.CLEAR INTRMENU
  GOTO INTCTLEND
  &Presult=0
  &nPrintRes=0
  &PlatformSet=0
)
;============================================================================
; Platform 8909
;============================================================================
if &PlatformNum==0x1
(
  &Presult=1
  &PlatformSet=1
  AREA.CLEAR INTRMENU
  &L2VICBASE=0x4110000
  &GPIOIntBase=0x1000000 
  &GPIOIntDirNum=0x2
  &DirCon0=0x47
  &DirCon1=0x48
  &MaxIRQ=0x106
  &DirCfgAddr=0x1101000
  &SumCfgAddr=0x01000008
  &StatusAddr=0x0100000C
  &PinCfg=0x01000000
  &InOut=0x01000004
  do GPIOIntL2VIC.cmm
)
;============================================================================
; Platform 9x07
;============================================================================
if &PlatformNum==0x2
(
  &Presult=1
  &PlatformSet=1
  AREA.CLEAR INTRMENU
  &L2VICBASE=0x4110000
  &GPIOIntBase=0x1000000 
  &GPIOIntDirNum=0x2
  &DirCon0=0x47
  &DirCon1=0x48
  &MaxIRQ=0x104
  &DirCfgAddr=0x1101000
  &SumCfgAddr=0x01000008
  &StatusAddr=0x0100000C
  &PinCfg=0x01000000
  &InOut=0x01000004
  do GPIOIntL2VIC.cmm
)
;============================================================================
; Platform 8937
;============================================================================
if &PlatformNum==0x3
(
  &Presult=1
  &PlatformSet=1
  AREA.CLEAR INTRMENU
  &L2VICBASE=0x4110000
  &GPIOIntBase=0x1000000 
  &GPIOIntDirNum=0x2
  &DirCon0=0x47
  &DirCon1=0x48
  &MaxIRQ=0x105
  &DirCfgAddr=0x1101000
  &SumCfgAddr=0x01000008
  &StatusAddr=0x0100000C
  &PinCfg=0x01000000
  &InOut=0x01000004
  do GPIOIntL2VIC.cmm
)

INTCTLEND:
AREA.CLEAR INTRMENU
AREA.RESET
WINCLEAR
term.close 
enddo (0==0)

ERRORHNDLRMAIN: 
  ENTRY &MenuEntry
  if &MenuEntry==0
  (
    print "  !! DATA ENTRY ERROR !!"
    print "  INVALID PLATFORM CONFIGURATION ENTERED"
  )
  if &MenuEntry==0x1
  (
    print " You chose QGIC platform for Applications Processor."
  )
  if &MenuEntry==0x2
  (
    print " You chose L2VIC platform for QDSP6 Modem."
  )
  if &MenuEntry==0x3
  (
    print " You chose L2VIC platform for QDSP6 LPASS."
  )
  if &MenuEntry==0x4
  (
    print " You chose QGIC platform for WLAN subsystem Pronto."
  )
RETURN
