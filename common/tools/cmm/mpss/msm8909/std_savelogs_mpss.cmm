//============================================================================
//  Name:                                                                     
//    std_savelogs_mpss.cmm 
//
//  Description:                                                              
//    Script to save MPSS memory locations
//                                                                            
// Copyright (c) 2012 - 2014 by Qualcomm Technologies, Incorporated.  All Rights Reserved.        
//
//
//
//
//                      EDIT HISTORY FOR FILE
//  This section contains comments describing changes made to the module.
//  Notice that changes are listed in reverse chronological order.
//
// when       who     		what, where, why
// --------   ---     		---------------------------------------------------------
// 11/01/2012 AJCheriyan	Added change to enable QDSS access to modem memory with XPU enabled
// 07/10/2012 AJCheriyan    Created for B-family 


// We support one argument for this script
// &ARG0 - Output location for the logs
ENTRY &ARG0

LOCAL &LOGLOCATION

MAIN:
	&LOGLOCATION="&ARG0"

	// Sanity check
	IF ("&LOGLOCATION"=="")
	(
	    PRINT %ERROR "Location to save logs not provided"
		GOTO FATALEXIT
	)

	// Load the memory map
	do std_memorymap mpss
	
	// Flush the caches or anything else we need to do 
	// before we save the binaries 
	GOSUB SYNCSTATE

	// Enable access to the memory region with XPU protection (MSSAuth) enabled
	GOSUB ENABLEACCESS

	// Save the memories first
	GOSUB SAVEBIN

	// Save the registers
	GOSUB SAVESTATE

	GOTO EXIT

SAVEBIN:
	do std_utils SAVEBIN &LOGLOCATION &SHARED_IMEM_log &SHARED_IMEM_start &SHARED_IMEM_size
	;do std_utils SAVEBIN &LOGLOCATION &MPSS_SW_log &MPSS_SW_start &MPSS_SW_size
	
	do std_intercom_init CHECKSESSION 1 APPS0
	 PRINT "Detecting APPS T32 session. Will exit if not found. "
	 do std_utils CHECKARGS FATALEXIT &APPS0_ALIVE 1.
	
	LOCAL &FULLPATH 
	&FULLPATH="&LOGLOCATION"+"/&MPSS_SW_log"
	 ;do std_intercom_do &APPS0_PORT data.save.binary &FULLPATH EAXI:&MPSS_SW_start++(&MPSS_SW_size-1)
	 data.save.binary &FULLPATH EAXI:&MPSS_SW_start++(&MPSS_SW_size-1)
	 &FULLPATH="&LOGLOCATION"+"/&MPSS_TCM_log"
	 data.save.binary &FULLPATH A:&MPSS_TCM_start++(&MPSS_TCM_size-1)
	RETURN 

ENABLEACCESS:
	// Once MBA enables the XPU to check for the MSSAuth signal before allowing access
	// to modem memory, QDSS is unable to access the region unless the DAP bit to enable 
	// access it set. do that here. Using the JTAG or AHB AP will require you to unlock
	// access. One less register write with the APB port.
	do hwio
	;DATA.SET EDAP:HWIO_QDSS_CS_QDSSCSR_DAPMSAVAL_ADDR %LONG 0x1
	RETURN
	
SYNCSTATE:
	// Flush the cache
	do std_flushcache QDSP6V56H
	RETURN 

SAVESTATE:
	LOCAL &CURR_THREAD
	&CURR_THREAD=REGISTER(HTID)
	
	THREAD 0
    do std_utils SAVEREGS &LOGLOCATION &MPSS_Thread0_regs
	THREAD 1
	do std_utils SAVEREGS &LOGLOCATION &MPSS_Thread1_regs
	THREAD 2
	do std_utils SAVEREGS &LOGLOCATION &MPSS_Thread2_regs
	THREAD 3
	do std_utils SAVEREGS &LOGLOCATION &MPSS_Thread3_regs
	// Return to the original thread
	THREAD &CURR_THREAD

	RETURN

FATALEXIT:
	END

EXIT:
	ENDDO


