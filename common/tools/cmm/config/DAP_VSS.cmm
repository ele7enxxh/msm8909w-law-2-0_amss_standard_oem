;*****************************************************************************
;**           AR_JTAG_MMSS.CMM                                              **
;**           29-01-2014   First version Adebnath                           **
;*****************************************************************************

ENTRY &ARG0 &ARG1 &ARG2

MAIN:



       IF (("&ARG0"=="MSM8909")||("&ARG0"=="msm8909"))
	(
		SYStem.Reset
		SYStem.CPU ARM926EJ
		SYStem.JTAGCLOCK CTCK 20.MHz
		SYStem.OPTION NOIRCHECK ON
		SYStem.OPTION WAITRESET OFF
		SYStem.OPTION ENRESET ON
		SYStem.OPTION RESBREAK OFF
		SYStem.CONFIG SLAVE ON

		SYStem.CONFIG MEMORYACCESSPORT 0.
		SYStem.CONFIG DEBUGACCESSPORT  1.
		SYStem.CONFIG JTAGACCESSPORT   2.
		SYStem.CONFIG COREJTAGPORT     1.

		SYStem.CONFIG DAPIRPOST 0.
		SYStem.CONFIG DAPDRPOST 0.
		SYStem.CONFIG DAPIRPOST 16.
		SYStem.CONFIG DAPDRPOST 2.

		SYStem.MEMACCESS DAP

		B.SEL PROGRAM AUTO

		TRONCHIP.SET SWI ON

		RADIX HEX
		SETUP.VAR %HEX.ON
		MODE.HLL

		autostore , history

		SYStem.STATE
	)

	IF ("&ARG0"=="MSM8916")
	(
		SYStem.Reset
		SYStem.CPU ARM926EJ
		SYStem.JTAGCLOCK CTCK 20.MHz
		SYStem.OPTION NOIRCHECK ON
		SYStem.OPTION WAITRESET OFF
		SYStem.OPTION ENRESET ON
		SYStem.OPTION RESBREAK OFF
		SYStem.CONFIG SLAVE ON

		SYStem.CONFIG MEMORYACCESSPORT 0.
		SYStem.CONFIG DEBUGACCESSPORT  1.
		SYStem.CONFIG JTAGACCESSPORT   2.
		SYStem.CONFIG COREJTAGPORT     1.

		SYStem.CONFIG DAPIRPOST 0.
		SYStem.CONFIG DAPDRPOST 0.
		SYStem.CONFIG DAPIRPOST 16.
		SYStem.CONFIG DAPDRPOST 2.

		SYStem.MEMACCESS DAP

		B.SEL PROGRAM AUTO

		TRONCHIP.SET SWI ON

		RADIX HEX
		SETUP.VAR %HEX.ON
		MODE.HLL

		autostore , history

		SYStem.STATE
	)
	
	IF (("&ARG0"=="MSM8939")||("&ARG0"=="msm8939")||("&ARG0"=="MSM8952")||("&ARG0"=="msm8952")||("&ARG0"=="MSM8976")||("&ARG0"=="msm8976"))
	(
		SYStem.Reset
		SYStem.CPU ARM926EJ
		SYStem.JTAGCLOCK CTCK 20.MHz
		SYStem.OPTION NOIRCHECK ON
		SYStem.OPTION WAITRESET OFF
		SYStem.OPTION ENRESET ON
		SYStem.OPTION RESBREAK OFF
		SYStem.CONFIG SLAVE ON

		SYStem.CONFIG MEMORYACCESSPORT 0.
		SYStem.CONFIG DEBUGACCESSPORT  1.
		SYStem.CONFIG JTAGACCESSPORT   2.
		SYStem.CONFIG COREJTAGPORT     1.

		SYStem.CONFIG DAPIRPOST 0.
		SYStem.CONFIG DAPDRPOST 0.
		SYStem.CONFIG DAPIRPOST 16.
		SYStem.CONFIG DAPDRPOST 2.

		SYStem.MEMACCESS DAP

		B.SEL PROGRAM AUTO

		TRONCHIP.SET SWI ON

		RADIX HEX
		SETUP.VAR %HEX.ON
		MODE.HLL

		autostore , history

		SYStem.STATE
	)

	IF (("&ARG0"=="MSM8929")||("&ARG0"=="msm8929"))
	(
		SYStem.Reset
		SYStem.CPU ARM926EJ
		SYStem.JTAGCLOCK CTCK 20.MHz
		SYStem.OPTION NOIRCHECK ON
		SYStem.OPTION WAITRESET OFF
		SYStem.OPTION ENRESET ON
		SYStem.OPTION RESBREAK OFF
		SYStem.CONFIG SLAVE ON

		SYStem.CONFIG MEMORYACCESSPORT 0.
		SYStem.CONFIG DEBUGACCESSPORT  1.
		SYStem.CONFIG JTAGACCESSPORT   2.
		SYStem.CONFIG COREJTAGPORT     1.

		SYStem.CONFIG DAPIRPOST 0.
		SYStem.CONFIG DAPDRPOST 0.
		SYStem.CONFIG DAPIRPOST 16.
		SYStem.CONFIG DAPDRPOST 2.

		SYStem.MEMACCESS DAP

		B.SEL PROGRAM AUTO

		TRONCHIP.SET SWI ON

		RADIX HEX
		SETUP.VAR %HEX.ON
		MODE.HLL

		autostore , history

		SYStem.STATE
	)

GOTO EXIT

EXIT:
	ENDDO



