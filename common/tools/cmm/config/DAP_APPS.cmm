//============================================================================
//  Name:                                                                     
//    DAP_APPS.cmm
//
//  Description:                                                              
//    Setup script for the Apps Processor
//                                                                            
// Copyright (c) 2012 - 2014 by Qualcomm Technologies, Incorporated.  All Rights Reserved.        
//
//
//
//
//                      EDIT HISTORY FOR FILE
//  This section contains comments describing changes made to the module.
//  Notice that changes are listed in reverse chronological order.
//
// when       who     		what, where, why
// --------   ---     		---------------------------------------------------------
// 11/21/2013 AJCheriyan    Update for Luxor
// 04/25/2013 AJCheriyan    Updated Gandalf settings
// 04/13/2013 AJCheriyan	Support for QDSS Gen 2
// 04/02/2013 AJCheriyan	Added SWDP support
// 02/11/2013 AJCheriyan	Added 8x26 support
// 01/31/2013 AJCheriyan	Added support for Cortex A7
// 08/26/2012 AJCheriyan	Dropped JTAG clock down to 20 MHz
// 08/25/2012 AJCheriyan	Boosted JTAG clock speed
// 07/10/2012 AJCheriyan    Created for B-family
//

// The script accepts two input arguments
// ARG0 - Chipset name
// ARG1 - Core number
// ARG2 - Cluster Number
// ARG3 - SWD
// Ideal case, the argument 'ARG0' would not have to be used
// as the parameters for a sub-system should be the same
// across the entire family of chipsets

ENTRY &ARG0 &ARG1 &ARG2 &ARG3

MAIN:

	IF (("&ARG0"=="MSM8974")||("&ARG0"=="msm8974"))
	(
		SYSTEM.CPU KRAIT
		SYSTEM.CONFIG SLAVE ON
 
		SYSTEM.JTAGCLOCK 15.0MHZ
		SYSTEM.CONFIG.MULTITAP NONE
		SYSTEM.CONFIG.MEMORYACCESSPORT 0.
		SYSTEM.CONFIG.DEBUGACCESSPORT 1.
		SYSTEM.CONFIG.JTAGACCESSPORT 2.
		SYSTEM.OPTION ENRESET OFF
		SYSTEM.OPTION CFLUSH OFF
		SYSTEM.CONFIG.DAPIRPOST 16.
		SYSTEM.CONFIG.DAPDRPOST 2.
		SYSTEM.CONFIG.DAPIRPRE 0.
		SYSTEM.CONFIG.DAPDRPRE 0.
		SYSTEM.MEMACCESS DAP
		SYSTEM.CONFIG CTICONFIG			   NONE
		SYSTEM.CONFIG.FUNNELBASE	0X80045000	
	    SYSTEM.CONFIG.ETBBASE		0x80007000
		SYSTEM.CONFIG.FUNNEL2BASE	0x80022000
		SYSTEM.CONFIG.ETBFUNNELBASE	0x8001B000
		SYSTEM.CONFIG.ETMETBFUNNELPORT	1.

		// Core Specific Setup	
		IF ("&ARG1"=="0")
		(
			SYSTEM.CONFIG COREBASE         0X80030000 
			SYSTEM.CONFIG ETMBASE          0X8003C000 
			SYSTEM.CONFIG ETMFUNNELPORT    0.
			SYSTEM.CONFIG.CTIBASE		   0X80041000
		)
		IF ("&ARG1"=="1")
		(

			SYSTEM.CONFIG COREBASE         0X80032000 
			SYSTEM.CONFIG ETMBASE          0X8003D000 
			SYSTEM.CONFIG ETMFUNNELPORT    1.
			SYSTEM.CONFIG.CTIBASE		   0X80042000
		)
		IF ("&ARG1"=="2")
		(

			SYSTEM.CONFIG COREBASE         0X80034000 
			SYSTEM.CONFIG ETMBASE          0X8003E000 
			SYSTEM.CONFIG ETMFUNNELPORT    2.
			SYSTEM.CONFIG.CTIBASE		   0X80043000
		)
		IF ("&ARG1"=="3")
		(

			SYSTEM.CONFIG COREBASE         0X80036000 
			SYSTEM.CONFIG ETMBASE          0X8003F000 
			SYSTEM.CONFIG ETMFUNNELPORT    3.
			SYSTEM.CONFIG.CTIBASE		   0X80044000
		)

		IF ("&ARG1"=="mp")
		(
			SYSTEM.CONFIG CORENUMBER	   4
			THREAD.ASSIGN 				   1. 2. 3. 4.
			SYSTEM.CONFIG COREBASE         0X80030000 0x80032000 0x80034000 0x80036000
			SYSTEM.CONFIG ETMBASE          0X8003C000 0x8003D000 0x8003E000 0x8003F000 
			SYSTEM.CONFIG ETMFUNNELPORT    0. 1. 2. 3.
			SYSTEM.CONFIG.CTIBASE		   0X80041000 0x80042000 0x80043000 0x80044000
		)


		TRONCHIP.SET FIQ OFF 
        TRONCHIP.SET IRQ OFF
	    TRONCHIP.SET DABORT OFF 
        TRONCHIP.SET PABORT OFF  
        TRONCHIP.SET UNDEF OFF
        TRONCHIP.SET SWI OFF 
        TRONCHIP.SET RESET OFF
		// Turn off ETM 
		ETM.OFF 
		
	)

	IF (("&ARG0"=="MSM8X26")||("&ARG0"=="msm8x26"))
	(
		SYSTEM.CPU CORTEXA7
		SYSTEM.CONFIG SLAVE ON
 
		SYSTEM.JTAGCLOCK 15.0MHZ
		SYSTEM.CONFIG.MULTITAP NONE
		SYSTEM.CONFIG.MEMORYACCESSPORT 0.
		SYSTEM.CONFIG.DEBUGACCESSPORT 1.
		SYSTEM.CONFIG.JTAGACCESSPORT 2.
		SYSTEM.CONFIG.DAPIRPOST 16.
		SYSTEM.CONFIG.DAPDRPOST 2.
		SYSTEM.CONFIG.DAPIRPRE 0.
		SYSTEM.CONFIG.DAPDRPRE 0.
		SYSTEM.OPTION ENRESET OFF
		SYSTEM.OPTION CFLUSH OFF
		SYSTEM.CONFIG CTICONFIG			   CORTEXV1
		SYSTEM.CONFIG.FUNNELBASE	0X80045000	
	    SYSTEM.CONFIG.ETBBASE		0x80007000
		SYSTEM.CONFIG.FUNNEL2BASE	0x80022000
		SYSTEM.CONFIG.ETBFUNNELBASE	0x8001B000
		SYSTEM.CONFIG.ETMETBFUNNELPORT	1.

		// Core Specific Setup	
		IF ("&ARG1"=="0")
		(
			SYSTEM.CONFIG COREBASE         0X80030000 
			SYSTEM.CONFIG ETMBASE          0X8003C000 
			SYSTEM.CONFIG ETMFUNNELPORT    0.
			SYSTEM.CONFIG.CTIBASE		   0X80041000
		)
		IF ("&ARG1"=="1")
		(

			SYSTEM.CONFIG COREBASE         0X80032000 
			SYSTEM.CONFIG ETMBASE          0X8003D000
			SYSTEM.CONFIG ETMFUNNELPORT    1.
			SYSTEM.CONFIG.CTIBASE		   0X80042000
		)
		IF ("&ARG1"=="2")
		(

			SYSTEM.CONFIG COREBASE         0X80034000 
			SYSTEM.CONFIG ETMBASE          0X8003E000 
			SYSTEM.CONFIG ETMFUNNELPORT    2.
			SYSTEM.CONFIG.CTIBASE		   0X80043000
		)
		IF ("&ARG1"=="3")
		(

			SYSTEM.CONFIG COREBASE         0X80036000 
			SYSTEM.CONFIG ETMBASE          0X8003F000 
			SYSTEM.CONFIG ETMFUNNELPORT    3.
			SYSTEM.CONFIG.CTIBASE		   0X80044000
		)
		IF ("&ARG1"=="mp")
		(
			SYSTEM.CPU CORTEXA7MPCORE
			SYSTEM.CONFIG CORENUMBER	   4
			THREAD.ASSIGN 				   1. 2. 3. 4.
			SYSTEM.CONFIG COREBASE         0X80030000 0X80032000 0X80034000 0X80036000
			SYSTEM.CONFIG ETMBASE          0X8003C000 0x8003D000 0x8003E000 0X8003F000 
			SYSTEM.CONFIG ETMFUNNELPORT    0. 1. 2. 3.
			SYSTEM.CONFIG.CTIBASE		   0X80041000 0X80042000 0X80043000 0X80044000
		)


		SYSTEM.MEMACCESS DAP
		TRONCHIP.SET FIQ OFF 
        TRONCHIP.SET IRQ OFF
	    TRONCHIP.SET DABORT OFF 
        TRONCHIP.SET PABORT OFF  
        TRONCHIP.SET UNDEF OFF
        TRONCHIP.SET SWI OFF 
        TRONCHIP.SET RESET OFF
		// Turn off ETM 
		ETM.OFF 
		
	)

	IF (("&ARG0"=="MSM8X10")||("&ARG0"=="msm8x10"))
	(
		SYSTEM.CPU CORTEXA7
		SYSTEM.CONFIG SLAVE ON
 
		SYSTEM.JTAGCLOCK 10.0MHZ
		SYSTEM.CONFIG.MULTITAP NONE
		SYSTEM.CONFIG.MEMORYACCESSPORT 0.
		SYSTEM.CONFIG.AXIACCESSPORT 0.
		SYSTEM.CONFIG.DEBUGACCESSPORT 1.
		SYSTEM.CONFIG.JTAGACCESSPORT 2.
		SYSTEM.CONFIG.DAPIRPOST 16.
		SYSTEM.CONFIG.DAPDRPOST 2.
		SYSTEM.CONFIG.DAPIRPRE 0.
		SYSTEM.CONFIG.DAPDRPRE 0.
		SYSTEM.OPTION ENRESET OFF
		SYSTEM.OPTION CFLUSH OFF
		SYSTEM.CONFIG CTICONFIG			   CORTEXV1
		SYSTEM.CONFIG.FUNNELBASE	0X80055000	
	    SYSTEM.CONFIG.ETBBASE		0x80025000
		SYSTEM.CONFIG.FUNNEL2BASE	0x80026000
		SYSTEM.CONFIG.ETBFUNNELBASE	0x80023000
		SYSTEM.CONFIG.ETMETBFUNNELPORT	1.

		// Core Specific Setup	
		IF ("&ARG1"=="0")
		(
			SYSTEM.CONFIG COREBASE         0X80040000 
			SYSTEM.CONFIG ETMBASE          0X8004C000 
			SYSTEM.CONFIG ETMFUNNELPORT    0.
			SYSTEM.CONFIG.CTIBASE		   0X80051000
		)
		IF ("&ARG1"=="1")
		(

			SYSTEM.CONFIG COREBASE         0X80042000 
			SYSTEM.CONFIG ETMBASE          0X8004D000
			SYSTEM.CONFIG ETMFUNNELPORT    1.
			SYSTEM.CONFIG.CTIBASE		   0X80052000
		)
		IF ("&ARG1"=="2")
		(

			SYSTEM.CONFIG COREBASE         0X80044000 
			SYSTEM.CONFIG ETMBASE          0X8004E000 
			SYSTEM.CONFIG ETMFUNNELPORT    2.
			SYSTEM.CONFIG.CTIBASE		   0X80053000
		)
		IF ("&ARG1"=="3")
		(

			SYSTEM.CONFIG COREBASE         0X80046000 
			SYSTEM.CONFIG ETMBASE          0X8004F000 
			SYSTEM.CONFIG ETMFUNNELPORT    3.
			SYSTEM.CONFIG.CTIBASE		   0X80054000
		)
		IF ("&ARG1"=="mp2")
		(
			SYSTEM.CPU CORTEXA7MPCORE
			SYSTEM.CONFIG CORENUMBER	   2
			THREAD.ASSIGN 				   1. 2.
			SYSTEM.CONFIG COREBASE         0X80040000 0X80042000
			SYSTEM.CONFIG ETMBASE          0X8004C000 0x8004D000
			SYSTEM.CONFIG ETMFUNNELPORT    0. 1.
			SYSTEM.CONFIG.CTIBASE		   0X80051000 0X80052000
		)
		IF ("&ARG1"=="mp4")
		(
			SYSTEM.CPU CORTEXA7MPCORE
			SYSTEM.CONFIG CORENUMBER	   4
			THREAD.ASSIGN 				   1. 2. 3. 4.
			SYSTEM.CONFIG COREBASE         0X80040000 0X80042000 0X80044000 0X80046000
			SYSTEM.CONFIG ETMBASE          0X8004C000 0x8004D000 0x8004E000 0X8004F000 
			SYSTEM.CONFIG ETMFUNNELPORT    0. 1. 2. 3.
			SYSTEM.CONFIG.CTIBASE		   0X80051000 0X80052000 0X80053000 0X80054000
		)


		SYSTEM.MEMACCESS DAP
		TRONCHIP.SET FIQ OFF 
        TRONCHIP.SET IRQ OFF
	    TRONCHIP.SET DABORT OFF 
        TRONCHIP.SET PABORT OFF  
        TRONCHIP.SET UNDEF OFF
        TRONCHIP.SET SWI OFF 
        TRONCHIP.SET RESET OFF
		// Turn off ETM 
		ETM.OFF 
		
	)

	IF (("&ARG0"=="APQ8084")||("&ARG0"=="apq8084")||("&ARG0"=="MSM8962")||("&ARG0"=="msm8962")||("&ARG0"=="MPQ8092")||("&ARG0"=="mpq8092"))
	(
		SYSTEM.CPU KRAIT
		SYSTEM.CONFIG SLAVE ON
 
		SYSTEM.JTAGCLOCK 10.0MHZ
		SYSTEM.CONFIG.MULTITAP NONE
		SYSTEM.CONFIG.MEMORYACCESSPORT 0.
		SYSTEM.CONFIG.AXIACCESSPORT 0.
		SYSTEM.CONFIG.DEBUGACCESSPORT 1.
		SYSTEM.CONFIG.JTAGACCESSPORT 2.
		SYSTEM.CONFIG.DAPIRPOST 16.
		SYSTEM.CONFIG.DAPDRPOST 2.
		SYSTEM.CONFIG.DAPIRPRE 0.
		SYSTEM.CONFIG.DAPDRPRE 0.
		SYSTEM.OPTION ENRESET OFF
		SYSTEM.OPTION CFLUSH OFF
		SYSTEM.CONFIG CTICONFIG			   CORTEXV1
		;SYSTEM.CONFIG.FUNNELBASE	0X80055000	
		;SYSTEM.CONFIG.ETBBASE		0x80025000
		;SYSTEM.CONFIG.FUNNEL2BASE	0x80022000
		;SYSTEM.CONFIG.ETBFUNNELBASE	0x80023000
		;SYSTEM.CONFIG.ETMETBFUNNELPORT	3.

		// Core Specific Setup	
		IF ("&ARG1"=="0")
		(
			SYSTEM.CONFIG COREBASE         0X80040000 
			SYSTEM.CONFIG ETMBASE          0X8004C000 
			SYSTEM.CONFIG ETMFUNNELPORT    0.
			SYSTEM.CONFIG.CTIBASE		   0X80051000
		)
		IF ("&ARG1"=="1")
		(

			SYSTEM.CONFIG COREBASE         0X80042000 
			SYSTEM.CONFIG ETMBASE          0X8004D000
			SYSTEM.CONFIG ETMFUNNELPORT    1.
			SYSTEM.CONFIG.CTIBASE		   0X80052000
		)
		IF ("&ARG1"=="2")
		(

			SYSTEM.CONFIG COREBASE         0X80044000 
			SYSTEM.CONFIG ETMBASE          0X8004E000 
			SYSTEM.CONFIG ETMFUNNELPORT    2.
			SYSTEM.CONFIG.CTIBASE		   0X80053000
		)
		IF ("&ARG1"=="3")
		(

			SYSTEM.CONFIG COREBASE         0X80046000 
			SYSTEM.CONFIG ETMBASE          0X8004F000 
			SYSTEM.CONFIG ETMFUNNELPORT    3.
			SYSTEM.CONFIG.CTIBASE		   0X80054000
		)


		SYSTEM.MEMACCESS DAP
		TRONCHIP.SET FIQ OFF 
        TRONCHIP.SET IRQ OFF
	    TRONCHIP.SET DABORT OFF 
        TRONCHIP.SET PABORT OFF  
        TRONCHIP.SET UNDEF OFF
        TRONCHIP.SET SWI OFF 
        TRONCHIP.SET RESET OFF
		// Turn off ETM 
		ETM.OFF 
		
	)

	IF (("&ARG0"=="MSM8909")||("&ARG0"=="msm8909"))
	(	
	
		SYStem.Reset
		SYStem.CPU CORTEXA7
		SYSTEM.JtagClock 20MHZ
		SYStem.CONFIG SLAVE OFF


		SYStem.Option EnReset OFF
		TrOnchip.Set RESET OFF


                ;SYStem.MEMACCESS DAP

		SYStem.CONFIG MEMORYACCESSPORT 0.
		SYStem.CONFIG AXIACCESSPORT 0.
		SYStem.CONFIG DEBUGACCESSPORT  1.

		SYStem.CONFIG CTICONFIG        CORTEXV1
                SYStem.CONFIG DAPIRPOST 0.
                SYStem.CONFIG DAPDRPOST 0.
                SYStem.CONFIG DAPIRPOST 16.
                SYStem.CONFIG DAPDRPOST 2.
        SYSTEM.option SYSPWRUPREQ OFF
        SYSTEM.option PWRDWN ON
 		IF ("&ARG1"=="0")
		(
           		SYStem.CONFIG COREBASE          DAP:0x80040000
                        SYStem.CONFIG ETMBASE		DAP:0x8004C000
;RS ??                        SYStem.CONFIG.ETB.BASE 		DAP:0x80025000
         		SYStem.CONFIG.CTIBASE	       DAP:0x80051000
			SYSTEM.CONFIG ETMFUNNELPORT    0.
		)
		IF ("&ARG1"=="1")
		(
  	               SYStem.CONFIG COREBASE		DAP:0x80042000
	               SYStem.CONFIG ETMBASE		DAP:0x8004D000 
                       SYStem.CONFIG.CTIBASE		DAP:0x80052000
;RS ??                        SYStem.CONFIG.ETB.BASE 		DAP:0x80025000
                       SYSTEM.CONFIG ETMFUNNELPORT    1.
                       SYStem.CONFIG SLAVE ON
		)
		IF ("&ARG1"=="2")
		(
	               SYStem.CONFIG COREBASE		DAP:0x80044000
	               SYStem.CONFIG ETMBASE		DAP:0x8004E000 
                       SYStem.CONFIG.CTIBASE		DAP:0x80053000
;RS ??                      SYStem.CONFIG.ETB.BASE 		DAP:0x80025000
                       SYSTEM.CONFIG ETMFUNNELPORT    2.
                       SYStem.CONFIG SLAVE ON

		)
		IF ("&ARG1"=="3")
		(

			SYStem.CONFIG COREBASE		DAP:0x80046000
                	SYStem.CONFIG ETMBASE		DAP:0x8004F000 
                	SYStem.CONFIG.CTIBASE		DAP:0x80054000
;RS ??                 	SYStem.CONFIG.ETB.BASE 		DAP:0x80025000
                        SYSTEM.CONFIG ETMFUNNELPORT    3.
                        SYStem.CONFIG SLAVE ON
		)


		SYStem.MEMACCESS DAP

	TRONCHIP.SET FIQ OFF 
        TRONCHIP.SET IRQ OFF
	TRONCHIP.SET DABORT OFF 
        TRONCHIP.SET PABORT OFF  
        TRONCHIP.SET UNDEF OFF
        TRONCHIP.SET SWI OFF 
        TRONCHIP.SET RESET OFF
		
		// Turn off ETM 
		ETM.OFF
		;sys.up
		system.option Enreset ON
		system.option resbreak OFF

)

	IF (("&ARG0"=="MSM8916")||("&ARG0"=="msm8916"))
	(	
	
		SYStem.Reset
		SYStem.CPU CORTEXA53
		SYSTEM.JtagClock 20MHZ
		SYStem.CONFIG SLAVE OFF


		SYStem.Option EnReset OFF
		TrOnchip.Set RESET OFF


                SYStem.MEMACCESS DAP

		SYStem.CONFIG MEMORYACCESSPORT 0.
		SYStem.CONFIG AXIACCESSPORT 0.
		SYStem.CONFIG DEBUGACCESSPORT  1

		SYStem.CONFIG CTICONFIG        ARMV8
                SYStem.CONFIG DAPIRPOST 0.
                SYStem.CONFIG DAPDRPOST 0.
                SYStem.CONFIG DAPIRPOST 16.
                SYStem.CONFIG DAPDRPOST 2.
   
 		IF ("&ARG1"=="0")
		(
           		SYStem.CONFIG COREBASE          DAP:0x80050000
                        SYStem.CONFIG ETMBASE		DAP:0x8005C000
                        SYStem.CONFIG.ETB.BASE 		DAP:0x80025000
         		SYStem.CONFIG.CTIBASE	       DAP:0x80058000
			SYSTEM.CONFIG ETMFUNNELPORT    0.
		)
		IF ("&ARG1"=="1")
		(
  	               SYStem.CONFIG COREBASE		DAP:0x80052000
	               SYStem.CONFIG ETMBASE		DAP:0x8005D000 
                       SYStem.CONFIG.CTIBASE		DAP:0x80059000
                       SYStem.CONFIG.ETB.BASE 		DAP:0x80025000
                       SYSTEM.CONFIG ETMFUNNELPORT    1.
		)
		IF ("&ARG1"=="2")
		(
	               SYStem.CONFIG COREBASE		DAP:0x80054000
	               SYStem.CONFIG ETMBASE		DAP:0x8005E000 
                       SYStem.CONFIG.CTIBASE		DAP:0x8005A000
                       SYStem.CONFIG.ETB.BASE 		DAP:0x80025000
                       SYSTEM.CONFIG ETMFUNNELPORT    2.

		)
		IF ("&ARG1"=="3")
		(

			SYStem.CONFIG COREBASE		DAP:0x80056000
                	SYStem.CONFIG ETMBASE		DAP:0x8005F000 
                	SYStem.CONFIG.CTIBASE		DAP:0x8005B000
                	SYStem.CONFIG.ETB.BASE 		DAP:0x80025000
                        SYSTEM.CONFIG ETMFUNNELPORT    2.
		)



		// Turn off ETM 
		ETM.OFF
		;sys.up
		system.option Enreset ON
		system.option resbreak OFF

)

	IF (("&ARG0"=="MSM8939")||("&ARG0"=="msm8939")||("&ARG0"=="MSM8952")||("&ARG0"=="msm8952"))
	(	
	
		SYStem.Reset
		SYStem.CPU CORTEXA53
		SYSTEM.JtagClock 20MHZ
		SYStem.Option EnReset OFF
		SYStem.CONFIG SLAVE OFF
		SYStem.CONFIG AXIACCESSPORT 	0.
		SYStem.CONFIG CTICONFIG        	ARMV8		
		
		TrOnchip.Set RESET OFF
        	SYStem.MEMACCESS DAP
		SYStem.CONFIG MEMORYACCESSPORT 0.
		SYStem.CONFIG DEBUGACCESSPORT  1
		SYStem.CONFIG DAPIRPOST 0.
		SYStem.CONFIG DAPDRPOST 0.
		SYStem.CONFIG DAPIRPOST 16.
		SYStem.CONFIG DAPDRPOST 2.
   
		//Cluster 1
		IF ("&ARG2"=="1")
		(
			IF ("&ARG1"=="0")
			(
				SYStem.CONFIG COREBASE          DAP:0x800F0000
				SYStem.CONFIG.CTIBASE	       	DAP:0x800F8000
				SYStem.CONFIG ETMBASE			DAP:0x800FC000
				SYStem.CONFIG.ETB.BASE 			DAP:0x80025000
				SYSTEM.CONFIG ETMFUNNELPORT    	0.
			)
			IF ("&ARG1"=="1")
			(
				SYStem.CONFIG COREBASE          DAP:0x800F2000
				SYStem.CONFIG.CTIBASE	       	DAP:0x800F9000
				SYStem.CONFIG ETMBASE		DAP:0x800FD000
				SYStem.CONFIG.ETB.BASE 		DAP:0x80025000
				SYSTEM.CONFIG ETMFUNNELPORT    	1.
				SYStem.CONFIG SLAVE ON
			)
			IF ("&ARG1"=="2")
			(
				SYStem.CONFIG COREBASE          DAP:0x800F4000
				SYStem.CONFIG.CTIBASE	       	DAP:0x800FA000
				SYStem.CONFIG ETMBASE		DAP:0x800FE000
				SYStem.CONFIG.ETB.BASE 		DAP:0x80025000
				SYSTEM.CONFIG ETMFUNNELPORT    	2.
				SYStem.CONFIG SLAVE ON
			)
			IF ("&ARG1"=="3")
			(
				SYStem.CONFIG COREBASE          DAP:0x800F6000
				SYStem.CONFIG.CTIBASE	       	DAP:0x800FB000
				SYStem.CONFIG ETMBASE		DAP:0x800FF000
				SYStem.CONFIG.ETB.BASE 		DAP:0x80025000
				SYSTEM.CONFIG ETMFUNNELPORT    	3.
				SYStem.CONFIG SLAVE ON
			)
		)
		
		//Cluster 0
		IF ("&ARG2"=="0")
		(
			IF ("&ARG1"=="0")
			(
				SYStem.CONFIG COREBASE          DAP:0x800D0000
				SYStem.CONFIG.CTIBASE	       	DAP:0x800D8000
				SYStem.CONFIG ETMBASE		DAP:0x800DC000
				SYStem.CONFIG.ETB.BASE 		DAP:0x80025000
				SYSTEM.CONFIG ETMFUNNELPORT    	0.
			)
			IF ("&ARG1"=="1")
			(
				SYStem.CONFIG COREBASE          DAP:0x800D2000
				SYStem.CONFIG.CTIBASE	       	DAP:0x800D9000
				SYStem.CONFIG ETMBASE		DAP:0x800DD000
				SYStem.CONFIG.ETB.BASE 		DAP:0x80025000
				SYSTEM.CONFIG ETMFUNNELPORT    	1.
				SYStem.CONFIG SLAVE ON
			)
			IF ("&ARG1"=="2")
			(
				SYStem.CONFIG COREBASE          DAP:0x800D4000
				SYStem.CONFIG.CTIBASE	       	DAP:0x800DA000
				SYStem.CONFIG ETMBASE		DAP:0x800DE000
				SYStem.CONFIG.ETB.BASE 		DAP:0x80025000
				SYSTEM.CONFIG ETMFUNNELPORT    	2.
				SYStem.CONFIG SLAVE ON

			)
			IF ("&ARG1"=="3")
			(
				SYStem.CONFIG COREBASE          DAP:0x800D6000
				SYStem.CONFIG.CTIBASE	       	DAP:0x800DB000
				SYStem.CONFIG ETMBASE		DAP:0x800DF000
				SYStem.CONFIG.ETB.BASE 		DAP:0x80025000
				SYSTEM.CONFIG ETMFUNNELPORT    	3.
				SYStem.CONFIG SLAVE ON
			)
		)

		// Turn off ETM 
		ETM.OFF
		system.option Enreset ON
		system.option resbreak OFF
	)

	IF (("&ARG0"=="MSM8976")||("&ARG0"=="msm8976"))
	(	
   		//Cluster 0
		IF ("&ARG2"=="0")
		(
			SYStem.Reset
			SYStem.CPU CORTEXA53
			SYSTEM.JtagClock 20MHZ
			SYStem.Option EnReset OFF
			SYStem.CONFIG SLAVE OFF
			SYStem.CONFIG AXIACCESSPORT 	0.
			SYStem.CONFIG CTICONFIG        	ARMV8		
			TrOnchip.Set RESET OFF
			SYStem.MEMACCESS DAP
			SYStem.CONFIG MEMORYACCESSPORT 0.
			SYStem.CONFIG DEBUGACCESSPORT  1
			SYStem.CONFIG DAPIRPOST 0.
			SYStem.CONFIG DAPDRPOST 0.
			SYStem.CONFIG DAPIRPOST 16.
			SYStem.CONFIG DAPDRPOST 2.
			
			IF ("&ARG1"=="0")
			(				
				SYStem.Option EnReset ON
				SYStem.CONFIG CORENUMBER 			1.
				SYStem.CONFIG COREBASE          DAP:0x80810000
				SYStem.CONFIG.CTIBASE	       	DAP:0x80820000
				SYStem.CONFIG ETMBASE			DAP:0x80840000
				SYStem.CONFIG.ETB.BASE 			DAP:0x80025000
				SYSTEM.CONFIG ETMFUNNELPORT    	0.
			)
			IF ("&ARG1"=="1")
			(
				SYStem.CONFIG CORENUMBER 			1.
				SYStem.CONFIG COREBASE          DAP:0x80910000
				SYStem.CONFIG.CTIBASE	       	DAP:0x80920000
				SYStem.CONFIG ETMBASE			DAP:0x80940000
				SYStem.CONFIG.ETB.BASE 			DAP:0x80025000
				SYSTEM.CONFIG ETMFUNNELPORT    	1.
				SYStem.CONFIG SLAVE ON
			)
			IF ("&ARG1"=="2")
			(
				SYStem.CONFIG CORENUMBER 			1.
				SYStem.CONFIG COREBASE          DAP:0x80a10000
				SYStem.CONFIG.CTIBASE	       	DAP:0x80a20000
				SYStem.CONFIG ETMBASE			DAP:0x80a40000
				SYStem.CONFIG.ETB.BASE 			DAP:0x80025000
				SYSTEM.CONFIG ETMFUNNELPORT    	2.
				SYStem.CONFIG SLAVE ON

			)
			IF ("&ARG1"=="3")
			(
				SYStem.CONFIG CORENUMBER 			1.
				SYStem.CONFIG COREBASE          DAP:0x80b10000
				SYStem.CONFIG.CTIBASE	       	DAP:0x80b20000
				SYStem.CONFIG ETMBASE			DAP:0x80b40000
				SYStem.CONFIG.ETB.BASE 			DAP:0x80025000
				SYSTEM.CONFIG ETMFUNNELPORT    	3.
				SYStem.CONFIG SLAVE ON
			)
		)

		//Cluster 1
		IF ("&ARG2"=="1")
		(	
			SYStem.Reset
			SYStem.CPU CORTEXA57
			SYSTEM.JtagClock 20MHZ
			SYStem.Option EnReset OFF
			SYStem.CONFIG SLAVE OFF
			SYStem.CONFIG AXIACCESSPORT 	0.
			SYStem.CONFIG CTICONFIG        	ARMV8		
			TrOnchip.Set RESET OFF
			SYStem.MEMACCESS DAP
			SYStem.CONFIG MEMORYACCESSPORT 0.
			SYStem.CONFIG DEBUGACCESSPORT  1
			SYStem.CONFIG DAPIRPOST 0.
			SYStem.CONFIG DAPDRPOST 0.
			SYStem.CONFIG DAPIRPOST 16.
			SYStem.CONFIG DAPDRPOST 2.
			
			IF ("&ARG1"=="0")
			(
				
				SYStem.CONFIG CORENUMBER 			1.
				SYStem.CONFIG COREBASE          DAP:0x80c10000
				SYStem.CONFIG.CTIBASE	       	DAP:0x80c20000
				SYStem.CONFIG ETMBASE			DAP:0x80c40000
				SYStem.CONFIG.ETB.BASE 			DAP:0x80025000
				SYSTEM.CONFIG ETMFUNNELPORT    	0.
			)
			IF ("&ARG1"=="1")
			(
				SYStem.CONFIG COREBASE          DAP:0x80d10000
				SYStem.CONFIG.CTIBASE	       	DAP:0x80d20000
				SYStem.CONFIG ETMBASE			DAP:0x80d40000
				SYStem.CONFIG.ETB.BASE 			DAP:0x80025000
				SYSTEM.CONFIG ETMFUNNELPORT    	1.
				SYStem.CONFIG SLAVE ON
			)
			IF ("&ARG1"=="2")
			(
				SYStem.CONFIG CORENUMBER 		1.
				SYStem.CONFIG COREBASE          DAP:0x80e10000
				SYStem.CONFIG.CTIBASE	       	DAP:0x80e20000
				SYStem.CONFIG ETMBASE			DAP:0x80e40000
				SYStem.CONFIG.ETB.BASE 			DAP:0x80025000
				SYSTEM.CONFIG ETMFUNNELPORT    	2.
				SYStem.CONFIG SLAVE ON
			)
			IF ("&ARG1"=="3")
			(
				SYStem.CONFIG CORENUMBER 		1.
				SYStem.CONFIG COREBASE          DAP:0x80f10000
				SYStem.CONFIG.CTIBASE	       	DAP:0x80f20000
				SYStem.CONFIG ETMBASE			DAP:0x80f30000
				SYStem.CONFIG.ETB.BASE 			DAP:0x80025000
				SYSTEM.CONFIG ETMFUNNELPORT    	3.
				SYStem.CONFIG SLAVE ON
			)
		)
		
		// Turn off ETM 
		ETM.OFF
		system.option Enreset ON
		system.option resbreak OFF
	)
	IF (("&ARG0"=="MSM8929")||("&ARG0"=="msm8929"))
	(	
	
		SYStem.Reset
		SYStem.CPU CORTEXA53
		SYSTEM.JtagClock 20MHZ
		SYStem.Option EnReset OFF
		SYStem.CONFIG SLAVE OFF
		SYStem.CONFIG AXIACCESSPORT 	0.
		SYStem.CONFIG CTICONFIG        	ARMV8		
		
		TrOnchip.Set RESET OFF
        SYStem.MEMACCESS DAP
		SYStem.CONFIG MEMORYACCESSPORT 0.
		SYStem.CONFIG DEBUGACCESSPORT  1
		SYStem.CONFIG DAPIRPOST 0.
		SYStem.CONFIG DAPDRPOST 0.
		SYStem.CONFIG DAPIRPOST 16.
		SYStem.CONFIG DAPDRPOST 2.
   
		//Cluster 1
		IF ("&ARG2"=="1")
		(
			IF ("&ARG1"=="0")
			(
				SYStem.CONFIG COREBASE          DAP:0x800F0000
				SYStem.CONFIG.CTIBASE	       	DAP:0x800F8000
				SYStem.CONFIG ETMBASE			DAP:0x800FC000
				SYStem.CONFIG.ETB.BASE 			DAP:0x80025000
				SYSTEM.CONFIG ETMFUNNELPORT    	0.
			)
			IF ("&ARG1"=="1")
			(
				SYStem.CONFIG COREBASE          DAP:0x800F2000
				SYStem.CONFIG.CTIBASE	       	DAP:0x800F9000
				SYStem.CONFIG ETMBASE		DAP:0x800FD000
				SYStem.CONFIG.ETB.BASE 		DAP:0x80025000
				SYSTEM.CONFIG ETMFUNNELPORT    	1.
				SYStem.CONFIG SLAVE ON
			)
			IF ("&ARG1"=="2")
			(
				SYStem.CONFIG COREBASE          DAP:0x800F4000
				SYStem.CONFIG.CTIBASE	       	DAP:0x800FA000
				SYStem.CONFIG ETMBASE		DAP:0x800FE000
				SYStem.CONFIG.ETB.BASE 		DAP:0x80025000
				SYSTEM.CONFIG ETMFUNNELPORT    	2.
				SYStem.CONFIG SLAVE ON
			)
			IF ("&ARG1"=="3")
			(
				SYStem.CONFIG COREBASE          DAP:0x800F6000
				SYStem.CONFIG.CTIBASE	       	DAP:0x800FB000
				SYStem.CONFIG ETMBASE		DAP:0x800FF000
				SYStem.CONFIG.ETB.BASE 		DAP:0x80025000
				SYSTEM.CONFIG ETMFUNNELPORT    	3.
				SYStem.CONFIG SLAVE ON
			)
		)
		
		//Cluster 0
		IF ("&ARG2"=="0")
		(
			IF ("&ARG1"=="0")
			(
				SYStem.CONFIG COREBASE          DAP:0x800D0000
				SYStem.CONFIG.CTIBASE	       	DAP:0x800D8000
				SYStem.CONFIG ETMBASE		DAP:0x800DC000
				SYStem.CONFIG.ETB.BASE 		DAP:0x80025000
				SYSTEM.CONFIG ETMFUNNELPORT    	0.
			)
			IF ("&ARG1"=="1")
			(
				SYStem.CONFIG COREBASE          DAP:0x800D2000
				SYStem.CONFIG.CTIBASE	       	DAP:0x800D9000
				SYStem.CONFIG ETMBASE		DAP:0x800DD000
				SYStem.CONFIG.ETB.BASE 		DAP:0x80025000
				SYSTEM.CONFIG ETMFUNNELPORT    	1.
				SYStem.CONFIG SLAVE ON
			)
			IF ("&ARG1"=="2")
			(
				SYStem.CONFIG COREBASE          DAP:0x800D4000
				SYStem.CONFIG.CTIBASE	       	DAP:0x800DA000
				SYStem.CONFIG ETMBASE		DAP:0x800DE000
				SYStem.CONFIG.ETB.BASE 		DAP:0x80025000
				SYSTEM.CONFIG ETMFUNNELPORT    	2.
				SYStem.CONFIG SLAVE ON

			)
			IF ("&ARG1"=="3")
			(
				SYStem.CONFIG COREBASE          DAP:0x800D6000
				SYStem.CONFIG.CTIBASE	       	DAP:0x800DB000
				SYStem.CONFIG ETMBASE		DAP:0x800DF000
				SYStem.CONFIG.ETB.BASE 		DAP:0x80025000
				SYSTEM.CONFIG ETMFUNNELPORT    	3.
				SYStem.CONFIG SLAVE ON
			)
		)
				// Turn off ETM 
		ETM.OFF
		system.option Enreset ON
		system.option resbreak OFF
	)

	// Common settings for all chipsets
	IF (("&ARG3"=="SWD")||("&ARG3"=="swd"))
	(
		SYSTEM.CONFIG SWDP ON 
		SYSTEM.CONFIG DEBUGPORTTYPE SWD
	)

	// Launch startup scripts
	IF (OS.ENV(STARTUPCMM)!="")
	(
        &STARTUPSCRIPT=OS.ENV(STARTUPCMM)
	    do &STARTUPSCRIPT
	)

	GOTO EXIT

EXIT:
	ENDDO
