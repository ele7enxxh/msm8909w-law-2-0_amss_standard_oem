//============================================================================
//  Name:                                                                     
//    startup.cmm 
//
//  Description:                                                              
//    Common startup script that calls the processor specific init scripts 
//                                                                            
// Copyright (c) 2012 - 2014 by Qualcomm Technologies, Incorporated.  All Rights Reserved.        
//
//
//
//
//                      EDIT HISTORY FOR FILE
//  This section contains comments describing changes made to the module.
//  Notice that changes are listed in reverse chronological order.
//
// when       who     		what, where, why
// --------   ---     		---------------------------------------------------------
// 12/03/2013 AJCheriyan	Added MPQ support
// 05/02/2013 AJCheriyan	Added support for History
// 04/18/2013 AJCheriyan	Added default access specifier option
// 04/04/2013 AJCheriyan	Added option for SWD connectivity
// 07/10/2012 AJCheriyan	Created for B-family
//

// Supports three input arguments 
// ARG0 - T32 connection property
// ARG1 - Chipset Name 
// ARG2 - Sub-system Name
// ARG3 - Core Number
// ARG4 - Connectivity option

ENTRY &ARG0 &ARG1 &ARG2 &ARG3 &ARG4

//cd ..\tools\cmm
// Global variables for the args passed in along with product flavor information
GLOBAL &T32PROP &CHIPSET &SUBSYS &CORENUM &PRODUCT_FLAVOR &CONNECT &ACCESS

// Save the arguments 
&T32PROP=STR.LWR("&ARG0")
&CHIPSET=STR.LWR("&ARG1")
&SUBSYS=STR.LWR("&ARG2")
&CORENUM=STR.LWR("&ARG3")
&CONNECT=STR.LWR("&ARG4")
&ACCESS="AHB"

// Set the default access specifier based on the chipset
IF (("&CHIPSET"=="msm8x10")||("&CHIPSET"=="apq8084")||("&CHIPSET"=="mpq8092"))
(
	&ACCESS="AXI"
)

// Set the default access specifier based on the chipset
IF (("&CHIPSET"=="msm8939")||("&CHIPSET"=="MSM8939"))
(
	&ACCESS="AXI"
)

IF (("&CHIPSET"=="msm8909")||("&CHIPSET"=="MSM8909"))
(
	&ACCESS="A"
)

IF (("&CHIPSET"=="msm8929")||("&CHIPSET"=="MSM8929"))
(
	&ACCESS="AXI"
)

IF (("&CHIPSET"=="msm8952")||("&CHIPSET"=="MSM8952"))
(
	&ACCESS="AXI"
)
IF (("&CHIPSET"=="msm8976")||("&CHIPSET"=="MSM8976"))
(
	&ACCESS="AXI"
)
// Locals used
LOCAL &SUBSYSCRIPT &SESSIONSCRIPT

// Now call the subsystem level script
&SUBSYSCRIPT="&T32PROP"+"_"+"&SUBSYS"
PRINT "Calling script: &SUBSYSCRIPT with args: &CHIPSET &CORENUM &CONNECT"
do config/&SUBSYSCRIPT &CHIPSET &CORENUM &CONNECT

// At this point we have the location of the scripts for 
// this session. Call the script to populate the build information
PRINT "Calling script: gen_buildinfo"
&TEMP=OS.ENV(TEMP)
do &TEMP/gen_buildinfo.cmm

// Now setup the scripts information first
PRINT "Calling script: std_toolsconfig with args: &CHIPSET &SUBSYS"
do std_toolsconfig &CHIPSET &SUBSYS

// Load up the product flavor information for the meta build
// PRODUCT_FLAVOR information is obtained from 
IF ("&PRODUCT_FLAVORS"=="")
(
	PRINT %ERROR "Product Flavor invalid. Invalid meta build configuration"
	GOTO FATALEXIT
)
IF (STR.SCAN("&PRODUCT_FLAVORS",",",0)<0.)
(
	// This means there is just one product flavor
	do gen_buildflavor &PRODUCT_FLAVORS
	&PRODUCT_FLAVOR="&PRODUCT_FLAVORS"
)
ELSE
(
	// Populate the data using the first one and make it the default
	&DEFAULT_FLAVOR=STR.MID("&PRODUCT_FLAVORS",0,STR.SCAN("&PRODUCT_FLAVORS",",",0))
 	do gen_buildflavor &DEFAULT_FLAVOR
	&PRODUCT_FLAVOR="&DEFAULT_FLAVOR"
)

// Perform the intercom initialization
do std_intercom_init NEWSESSION

// Now perform the debug session specific setup
// Pass the sub-system name along as well
PRINT "Calling script: std_sessioncfg with args: &SUBSYS"
&SESSIONSCRIPT="std_sessioncfg_"+STR.LWR("&SUBSYS")
do &SESSIONSCRIPT &CHIPSET

// Now save the history as well
AUTOSTORE , HISTORY

EXIT:
	ENDDO

FATALEXIT:
	END

