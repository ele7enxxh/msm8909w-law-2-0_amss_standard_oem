//============================================================================
//  Name:                                                                     
//    std_loadbuild_la.cmm 
//
//  Description:                                                              
//    LA Specific Build loading script
//                                                                            
// Copyright (c) 2012 - 2014 by Qualcomm Technologies, Incorporated.  All Rights Reserved.        
//
//
//
//
//                      EDIT HISTORY FOR FILE
//  This section contains comments describing changes made to the module.
//  Notice that changes are listed in reverse chronological order.
//
// when       who     		what, where, why
// --------   ---     		---------------------------------------------------------
// 10/01/2012 AJCheriyan	Removed SDI image loading for good (needs boot support)
// 09/13/2012 AJCheriyan	Added SDI image loading (add partition.xml changes)
// 09/07/2012 AJCheriyan	Removed SDI image loading (revert partition.xml changes )
// 09/02/2012 AJCheriyan	Added SDI image loading
// 08/08/2012 AJCheriyan	Fixed issue with paths for mjsdload
// 07/19/2012 AJCheriyan    Created for B-family 

// ARG0 - Load option - Supported : ERASEONLY, LOADCOMMON, LOADFULL
ENTRY &ARG0

LOCAL &CWD &SEARCHPATHS &STORAGE_OPTION &STORAGE_TYPE &PROGRAMMER &PARTITION
LOCAL &XML &MAX_PARTITIONS &XML_LOCATION &BINARY &BINARYPATH &PROGRAMMER_NAND &PROGRAMMER_ERASE &TYPE

MAIN:
	// We have checked for all the intercom sessions at this point and we don't need any error
	// Save the argument
	&LOAD_OPTION="&ARG0"

	// Switch to the tools directory
	&CWD=OS.PWD()
	
	// Enable the MPM counter
	d.S D:0x004A1000 %LE %LONG 0x1
	
	;WAIT 5s
	
	cd &COMMON_METASCRIPTSDIR/msm8909
	do spmiCfg.cmm 8909 true
	do pmicpeek.cmm 0x14746 0x0 0x80

	
	cd &CWD
	
	// Check for the boot option
	//do hwio
	y.create.l HWIO_BOOT_CONFIG_ADDR A:0x5e02c
	Y.CREATE.L HWIO_BOOT_CONFIG_FAST_BOOT_BMSK 0x1e
	Y.CREATE.L HWIO_BOOT_CONFIG_FAST_BOOT_SHFT 0x1
	y.create.done
        do std_utils HWIO_INF BOOT_CONFIG FAST_BOOT
        ENTRY &STORAGE_OPTION
	
	IF (&STORAGE_OPTION==0x4)
    (
        &PROGRAMMER="boot_images/core/storage/flash/tools/src/nand/load_image"
		&PROGRAMMER_NAND="boot_images/core/storage/flash/tools/src/nand/mjnand"
		&PROGRAMMER_ERASE="boot_images/core/storage/flash/tools/src/nand/erasenand.cmm"
        &STORAGE_TYPE="nand"
       
    )
    ELSE IF (&STORAGE_OPTION==0x0)
	(
		&PROGRAMMER="boot_images/core/storage/tools/jsdcc/mjsdload"
		&XML_LOCATION="&METASCRIPTSDIR/../../build"
		&STORAGE_TYPE="emmc"
		&MAX_PARTITIONS=1
	)
	ELSE
	(
		PRINT %ERROR "&STORAGE_OPTION Invalid Storage Option"	
		GOTO FATALEXIT
	)
	
	// Erase only
	IF (("&ARG0"=="ERASEONLY")||("&ARG0"=="LOADCOMMON")||("&ARG0"=="LOADFULL"))
	(
		IF ("&STORAGE_TYPE"=="nand")
    	(
            // Only erase the chip and exit
            CD.DO &BOOT_BUILDROOT/&PROGRAMMER_ERASE NOMENU
		)
		ELSE IF("&STORAGE_TYPE"=="emmc")
		(
			CD.DO &BOOT_BUILDROOT/&PROGRAMMER ERASE
		)
	)

	// Load common images
	IF (("&ARG0"=="LOADCOMMON")||("&ARG0"=="LOADFULL"))
	(
		// Check for all the common images 

		// Check for the presence of all the binaries
		// Not needed because meta-build should have populated all this information
		// SBL, TZ, RPM, APPSBL, SDI
		do std_utils FILEXIST FATALEXIT &BOOT_BUILDROOT/&BOOT_BINARY
		do std_utils FILEXIST FATALEXIT &RPM_BUILDROOT/&RPM_BINARY
		//do std_utils FILEXIST FATALEXIT &APPS_BUILDROOT/&APPSBOOT_BINARY
		do std_utils FILEXIST FATALEXIT &TZ_BUILDROOT/&QSEE_BINARY
		
		;WAIT 5s
		if ("&STORAGE_TYPE"=="emmc")
		( 
			// Now flash them all one by one 
			// Flash the partition table
			&SEARCHPATHS="&METASCRIPTSDIR/../../build"
			CD.DO &BOOT_BUILDROOT/&PROGRAMMER LOAD searchpaths=&SEARCHPATHS xml=rawprogram0.xml files=gpt_main0.bin
			
			;WAIT 2s
			CD.DO &BOOT_BUILDROOT/&PROGRAMMER LOAD searchpaths=&SEARCHPATHS xml=rawprogram0.xml files=gpt_backup0.bin
			
			;WAIT 2s	
			// Apply the disk patches
			&SEARCHPATHS="&METASCRIPTSDIR/../../build"
			CD.DO &BOOT_BUILDROOT/&PROGRAMMER PATCH searchpaths=&SEARCHPATHS xml=patch0.xml
			
			;WAIT 2s
			// SBL
			&SEARCHPATHS="&METASCRIPTSDIR/../../build,"+OS.FILE.PATH(&BOOT_BUILDROOT/&BOOT_BINARY)
			CD.DO &BOOT_BUILDROOT/&PROGRAMMER LOAD searchpaths=&SEARCHPATHS xml=rawprogram0.xml files=sbl1.mbn

			// QSEE
			;WAIT 2s
			&SEARCHPATHS="&METASCRIPTSDIR/../../build,"+OS.FILE.PATH(&TZ_BUILDROOT/&QSEE_BINARY)
			CD.DO &BOOT_BUILDROOT/&PROGRAMMER LOAD searchpaths=&SEARCHPATHS xml=rawprogram0.xml files=tz.mbn
							
			// RPM
			;WAIT 2s
			&SEARCHPATHS="&METASCRIPTSDIR/../../build,"+OS.FILE.PATH(&RPM_BUILDROOT/&RPM_BINARY)
			CD.DO &BOOT_BUILDROOT/&PROGRAMMER LOAD searchpaths=&SEARCHPATHS xml=rawprogram0.xml files=rpm.mbn
		)
		ELSE IF("&STORAGE_TYPE"=="nand")
		(
			do std_utils FILEXIST FATALEXIT &PARTITION_METASCRIPTSDIR/partition.mbn
			DO &BOOT_BUILDROOT/&PROGRAMMER partition &PARTITION_METASCRIPTSDIR/partition.mbn				           
			DO &BOOT_BUILDROOT/&PROGRAMMER sbl  &BOOT_BUILDROOT/&BOOT_BINARY
			DO &BOOT_BUILDROOT/&PROGRAMMER rpm  &RPM_BUILDROOT/&RPM_BINARY
			DO &BOOT_BUILDROOT/&PROGRAMMER appsboot &APPS_BUILDROOT/&APPSBOOT_BINARY
			DO &BOOT_BUILDROOT/&PROGRAMMER tz  &TZ_BUILDROOT/&QSEE_BINARY
			CD.DO &BOOT_BUILDROOT/&PROGRAMMER_NAND NOMENU AAATANAA
		)
	)
	// Load HLOS images
	IF ("&LOAD_OPTION"=="LOADFULL")
	(
		if ("&STORAGE_TYPE"=="emmc")
		(
			// Apps Bootloader
			&SEARCHPATHS="&METASCRIPTSDIR/../../build,"+OS.FILE.PATH(&APPS_BUILDROOT/&APPSBOOT_BINARY)
			CD.DO &BOOT_BUILDROOT/&PROGRAMMER LOAD searchpaths=&SEARCHPATHS xml=rawprogram0.xml files=emmc_appsboot.mbn

			// Change the active partition. This is needed only if the user flashes an HLOS that needs
			// a different partition
			CD.DO &BOOT_BUILDROOT/&PROGRAMMER 9 activeboot=0
		)
   		// Call the script to fastboot the remaining images
		OS.COMMAND cmd /k python &METASCRIPTSDIR/../../build/fastboot_all.py --ap=&APPS_BUILDROOT --pf=&PRODUCT_FLAVOR
	)

	// Return to the old directory
	CD &CWD

	GOTO EXIT


FATALEXIT:
	END

EXIT:
	ENDDO



	
	
	

		

