//============================================================================
//  Name:                                                                     
//    std_loadsim_apps.cmm 
//
//  Description:                                                              
//    Script to load APPS logs
//                                                                            
// Copyright (c) 2012 - 2014 by Qualcomm Technologies, Incorporated.  All Rights Reserved.        
//
//
//
//
//                      EDIT HISTORY FOR FILE
//  This section contains comments describing changes made to the module.
//  Notice that changes are listed in reverse chronological order.
//
// when       who     		what, where, why
// --------   ---     		---------------------------------------------------------
// 09/06/2012 AJCheriyan	Added USB RAM dump support
// 08/31/2012 AJCheriyan    Created for B-family 
//

// We support the following arguments
// ARG0 - Chipset Name. Can be used to setup sub-system according to target if needed 
// Using this argument should be avoided unless absolutely necessary
// ARG1 - LOGTYPE 
// ARG2 - BUILD
// ARG3 - LOGLOCATION
//
ENTRY &ARG0 &ARG1 &ARG2 &ARG3

LOCAL &LOGTYPE &BUILD &LOGLOCATION
MAIN:
	&LOGTYPE="&ARG1"
	&BUILD="&ARG2"
	&LOGLOCATION="&ARG3"

	// Load the memory map
	do std_memorymap

	// Setup the environment
	do std_setupenv

	// First, all the sanity checks
	GOSUB CHECKBINARIES
	
	// Binaries look good. Else, we wouldn't be here	
	GOSUB SETUPSIM
	
	// Load the binaries
	GOSUB LOADBIN

	// Load the symbols
	// do std_loadsyms_apps &BUILD

	// Load the "state" at the time of the crash
	GOSUB RESTORESTATE

	// Off you go..
	GOTO EXIT

// Set the simulator for the processor we want
SETUPSIM:
	SYS.CPU CORTEXA7
	SYS.UP

	RETURN

// Checks if the binaries for the system are present in the location
// Loglocation should not be empty and assumes memory map is loaded
CHECKBINARIES:
LOCAL &FILE1 &FILE2 &LOGCLASS


	// This is the best place to determine the type of the log too
	IF ("&LOGTYPE"=="AUTODETECT")
	(
	    &LOGCLASS="&LOGTYPE"
		
		do std_utils FILEXIST EXIT &LOGLOCATION &HLOS_1_log
		ENTRY &FILE1

	    IF ("&FILE1"=="TRUE")
		(
		     &LOGCLASS="JTAG"
	    )

		// Check for USB logs
		do std_utils FILEXIST EXIT &LOGLOCATION &DDR_1_USB_log
		ENTRY &FILE1

		IF ("&FILE1"=="TRUE")
		(
			&LOGCLASS="USB"
		)

		// If we even after that, we are stuck with "AUTODETECT" we have a problem
		IF ("&LOGCLASS"=="AUTODETECT")
		(
		    PRINT %%ERROR "Neither USB nor JTAG logs present in folder: &LOGLOCATION"
		    GOTO FATALEXIT
		)
		ELSE
		(
		    // Safe to change the logtype
			&LOGTYPE="&LOGCLASS"
		)
	)

	IF ("&LOGTYPE"=="JTAG")
	(
		
		// Check for JTAG logs
		do std_utils FILEXIST EXIT &LOGLOCATION &HLOS_1_log
		ENTRY &FILE1

	    IF ("&FILE1"=="FALSE")
		(
			PRINT %ERROR "JTAG logs not present in folder: &LOGLOCATION"
			GOTO FATALEXIT
	    )
	)

	IF ("&LOGTYPE"=="USB")
	(
		
		// Check for USB logs
		do std_utils FILEXIST EXIT &LOGLOCATION &DDR_1_USB_log
		ENTRY &FILE1

	    IF ("&FILE1"=="FALSE")
		(
			PRINT %ERROR "USB logs not present in folder: &LOGLOCATION"
			GOTO FATALEXIT
	    )
	)	
	    		
	RETURN


// Function :LOADBIN
// Loads the saved binaries
LOADBIN:
	
	LOCAL &FILEPRESENT

	IF ("&LOGTYPE"=="JTAG")
	(

		do std_utils FILEXIST EXIT &LOGLOCATION &HLOS_1_log
		ENTRY &FILEPRESENT
		IF ("&FILEPRESENT"=="TRUE")
		(
	 		do std_utils LOADBIN &LOGLOCATION &HLOS_1_log &HLOS_1_start
		)

		do std_utils FILEXIST EXIT &LOGLOCATION &HLOS_2_log
		ENTRY &FILEPRESENT
		IF ("&FILEPRESENT"=="TRUE")
		(
	 		do std_utils LOADBIN &LOGLOCATION &HLOS_2_log &HLOS_2_start
		)

		//do std_utils FILEXIST EXIT &LOGLOCATION &HLOS_3_log
		//ENTRY &FILEPRESENT
		//IF ("&FILEPRESENT"=="TRUE")
		//(
		// 	do std_utils LOADBIN &LOGLOCATION &HLOS_3_log &HLOS_3_start
		//)

		//do std_utils FILEXIST EXIT &LOGLOCATION &HLOS_3_log
		//ENTRY &FILEPRESENT
		//IF ("&FILEPRESENT"=="TRUE")
		//(
	 	//	do std_utils LOADBIN &LOGLOCATION &HLOS_3_log &HLOS_3_start
		//)
	)

		
	IF ("&LOGTYPE"=="USB")
	(
		do std_utils FILEXIST EXIT &LOGLOCATION &DDR_1_USB_log
		ENTRY &FILEPRESENT
		IF ("&FILEPRESENT"=="TRUE")
		(
	 		do std_utils LOADBIN &LOGLOCATION &DDR_1_USB_log &DDR_1_start
		)

		do std_utils FILEXIST EXIT &LOGLOCATION &DDR_2_USB_log
		ENTRY &FILEPRESENT
		IF ("&FILEPRESENT"=="TRUE")
		(
	 		do std_utils LOADBIN &LOGLOCATION &DDR_2_USB_log &DDR_2_start
		)
	)

	RETURN

// Function: RESTORESTATE
// To load the error information from the saved logs
RESTORESTATE:
	// Restore the registers from file if JTAG logs
	IF ("&LOGTYPE"=="JTAG")
	(
	        print "choose the path to vmlinux"
	    d.load.elf *.* /nocode /noclear
	 	do std_utils EXECUTESCRIPT EXIT &LOGLOCATION/&APPS_Core0_regs
		do std_utils EXECUTESCRIPT EXIT &LOGLOCATION/&APPS_Core0_mmu
	)

	RETURN

FATALEXIT:
	END

EXIT:
	ENDDO


