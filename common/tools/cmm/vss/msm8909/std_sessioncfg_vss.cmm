//============================================================================
//  Name:                                                                     
//    std_sessioncfg_wcnss.cmm 
//
//  Description:                                                              
//    Script to setup sub-system level features
//                                                                            
// Copyright (c) 2012 - 2014 by Qualcomm Technologies, Incorporated.  All Rights Reserved.        
//
//
//
//
//                      EDIT HISTORY FOR FILE
//  This section contains comments describing changes made to the module.
//  Notice that changes are listed in reverse chronological order.
//
// when       who     		what, where, why
// --------   ---     		---------------------------------------------------------
// 09/27/2012 AJCheriyan	Fixed bug caused by typo
// 09/12/2012 AJCheriyan	Reset menu
// 07/10/2012 AJCheriyan    Created for B-family 
//

// We support only one argument for all session config scripts
// ARG0 - Chipset Name. Can be used to setup sub-system according to target if needed 
// Using this argument should be avoided unless absolutely necessary
ENTRY &ARG0

MAIN:
	// Do common environment setup
	do std_setupenv.cmm

	// Clear all the windows
	WINCLEAR

EXIT:
   ENDDO
   

