Local &baseOffset

if state.processor()=="CortexM3"
(
    &baseOffset=0x60000000
)

y.create.l HWIO_SPMI_GENI_CLK_CTRL_ADDR A:(&baseOffset+0x200a000)
y.create.l HWIO_SPMI_GENI_HW_VERSION_ADDR A:(&baseOffset+0x200a004)
y.create.l HWIO_SPMI_GENI_FW_REVISION_ADDR A:(&baseOffset+0x200a008)
y.create.l HWIO_SPMI_GENI_S_FW_REVISION_ADDR A:(&baseOffset+0x200a00c)
y.create.l HWIO_SPMI_GENI_FORCE_DEFAULT_REG_ADDR A:(&baseOffset+0x200a010)
y.create.l HWIO_SPMI_GENI_OUTPUT_CTRL_ADDR A:(&baseOffset+0x200a014)
y.create.l HWIO_SPMI_GENI_CGC_CTRL_ADDR A:(&baseOffset+0x200a018)
y.create.l HWIO_SPMI_GENI_CHAR_CFG_ADDR A:(&baseOffset+0x200a01c)
y.create.l HWIO_SPMI_GENI_CHAR_DATA_0_ADDR A:(&baseOffset+0x200a020)
y.create.l HWIO_SPMI_GENI_CHAR_DATA_1_ADDR A:(&baseOffset+0x200a024)
y.create.l HWIO_SPMI_GENI_CTRL_ADDR A:(&baseOffset+0x200a028)
y.create.l HWIO_SPMI_GENI_STATUS_ADDR A:(&baseOffset+0x200a02c)
y.create.l HWIO_SPMI_GENI_TEST_BUS_CTRL_ADDR A:(&baseOffset+0x200a030)
y.create.l HWIO_SPMI_GENI_SER_CLK_CFG_ADDR A:(&baseOffset+0x200a034)
y.create.l HWIO_SPMI_GENI_TX_WATERMARK_REG_ADDR A:(&baseOffset+0x200a038)
y.create.l HWIO_SPMI_GENI_RX_WATERMARK_REG_ADDR A:(&baseOffset+0x200a03c)
y.create.l HWIO_SPMI_GENI_STOP_REG_ADDR A:(&baseOffset+0x200a040)
y.create.l HWIO_SPMI_GENI_SW_COMP_REG_ADDR A:(&baseOffset+0x200a044)
y.create.l HWIO_SPMI_GENI_PROG_ROM_CTRL_REG_ADDR A:(&baseOffset+0x200a048)
y.create.l HWIO_SPMI_GENI_CFG_REG0_ADDR A:(&baseOffset+0x200a100)
y.create.l HWIO_SPMI_GENI_CFG_REG1_ADDR A:(&baseOffset+0x200a104)
y.create.l HWIO_SPMI_GENI_CFG_REG2_ADDR A:(&baseOffset+0x200a108)
y.create.l HWIO_SPMI_GENI_CFG_REG3_ADDR A:(&baseOffset+0x200a10c)
y.create.l HWIO_SPMI_GENI_CFG_REG4_ADDR A:(&baseOffset+0x200a110)
y.create.l HWIO_SPMI_GENI_CFG_REG5_ADDR A:(&baseOffset+0x200a114)
y.create.l HWIO_SPMI_GENI_CFG_REG6_ADDR A:(&baseOffset+0x200a118)
y.create.l HWIO_SPMI_GENI_CFG_REG7_ADDR A:(&baseOffset+0x200a11c)
y.create.l HWIO_SPMI_GENI_CFG_REG8_ADDR A:(&baseOffset+0x200a120)
y.create.l HWIO_SPMI_GENI_CFG_REG9_ADDR A:(&baseOffset+0x200a124)
y.create.l HWIO_SPMI_GENI_CFG_REG10_ADDR A:(&baseOffset+0x200a128)
y.create.l HWIO_SPMI_GENI_CFG_REG11_ADDR A:(&baseOffset+0x200a12c)
y.create.l HWIO_SPMI_GENI_CFG_REG12_ADDR A:(&baseOffset+0x200a130)
y.create.l HWIO_SPMI_GENI_CFG_REG13_ADDR A:(&baseOffset+0x200a134)
y.create.l HWIO_SPMI_GENI_CFG_REG14_ADDR A:(&baseOffset+0x200a138)
y.create.l HWIO_SPMI_GENI_CFG_REG15_ADDR A:(&baseOffset+0x200a13c)
y.create.l HWIO_SPMI_GENI_CFG_REG16_ADDR A:(&baseOffset+0x200a140)
y.create.l HWIO_SPMI_GENI_CFG_REG17_ADDR A:(&baseOffset+0x200a144)
y.create.l HWIO_SPMI_GENI_CFG_REG18_ADDR A:(&baseOffset+0x200a148)
y.create.l HWIO_SPMI_GENI_CFG_REG19_ADDR A:(&baseOffset+0x200a14c)
y.create.l HWIO_SPMI_GENI_CFG_REG20_ADDR A:(&baseOffset+0x200a150)
y.create.l HWIO_SPMI_GENI_CFG_REG21_ADDR A:(&baseOffset+0x200a154)
y.create.l HWIO_SPMI_GENI_CFG_REG22_ADDR A:(&baseOffset+0x200a158)
y.create.l HWIO_SPMI_GENI_CFG_REG23_ADDR A:(&baseOffset+0x200a15c)
y.create.l HWIO_SPMI_GENI_CFG_REG24_ADDR A:(&baseOffset+0x200a160)
y.create.l HWIO_SPMI_GENI_CFG_REG25_ADDR A:(&baseOffset+0x200a164)
y.create.l HWIO_SPMI_GENI_CFG_REG26_ADDR A:(&baseOffset+0x200a168)
y.create.l HWIO_SPMI_GENI_CFG_REG27_ADDR A:(&baseOffset+0x200a16c)
y.create.l HWIO_SPMI_GENI_CFG_REG28_ADDR A:(&baseOffset+0x200a170)
y.create.l HWIO_SPMI_GENI_CFG_REG29_ADDR A:(&baseOffset+0x200a174)
y.create.l HWIO_SPMI_GENI_CFG_REG30_ADDR A:(&baseOffset+0x200a178)
y.create.l HWIO_SPMI_GENI_CFG_RAM0_ADDR A:(&baseOffset+0x200a200)
y.create.l HWIO_SPMI_GENI_CFG_RAM1_ADDR A:(&baseOffset+0x200a204)
y.create.l HWIO_SPMI_GENI_CFG_RAM2_ADDR A:(&baseOffset+0x200a208)
y.create.l HWIO_SPMI_GENI_CFG_RAM3_ADDR A:(&baseOffset+0x200a20c)
y.create.l HWIO_SPMI_GENI_CFG_RAM4_ADDR A:(&baseOffset+0x200a210)
y.create.l HWIO_SPMI_GENI_CFG_RAM5_ADDR A:(&baseOffset+0x200a214)
y.create.l HWIO_SPMI_GENI_CFG_RAM6_ADDR A:(&baseOffset+0x200a218)
y.create.l HWIO_SPMI_GENI_CFG_RAM7_ADDR A:(&baseOffset+0x200a21c)
y.create.l HWIO_SPMI_GENI_CFG_RAM8_ADDR A:(&baseOffset+0x200a220)
y.create.l HWIO_SPMI_GENI_CFG_RAM9_ADDR A:(&baseOffset+0x200a224)
y.create.l HWIO_SPMI_PERIPH0_2OWNER_TABLE_REG_ADDR A:(&baseOffset+0x200a700)
y.create.l HWIO_SPMI_PERIPH1_2OWNER_TABLE_REG_ADDR A:(&baseOffset+0x200a704)
y.create.l HWIO_SPMI_PERIPH2_2OWNER_TABLE_REG_ADDR A:(&baseOffset+0x200a708)
y.create.l HWIO_SPMI_PERIPH3_2OWNER_TABLE_REG_ADDR A:(&baseOffset+0x200a70c)
y.create.l HWIO_SPMI_PERIPH4_2OWNER_TABLE_REG_ADDR A:(&baseOffset+0x200a710)
y.create.l HWIO_SPMI_PERIPH5_2OWNER_TABLE_REG_ADDR A:(&baseOffset+0x200a714)
y.create.l HWIO_SPMI_PERIPH6_2OWNER_TABLE_REG_ADDR A:(&baseOffset+0x200a718)
y.create.l HWIO_SPMI_PERIPH7_2OWNER_TABLE_REG_ADDR A:(&baseOffset+0x200a71c)
y.create.l HWIO_SPMI_PERIPH8_2OWNER_TABLE_REG_ADDR A:(&baseOffset+0x200a720)
y.create.l HWIO_SPMI_PERIPH9_2OWNER_TABLE_REG_ADDR A:(&baseOffset+0x200a724)
y.create.l HWIO_SPMI_MAPPING_TABLE_REG0_ADDR A:(&baseOffset+0x200ab00)
y.create.l HWIO_SPMI_MAPPING_TABLE_REG1_ADDR A:(&baseOffset+0x200ab04)
y.create.l HWIO_SPMI_MAPPING_TABLE_REG2_ADDR A:(&baseOffset+0x200ab08)
y.create.l HWIO_SPMI_MAPPING_TABLE_REG3_ADDR A:(&baseOffset+0x200ab0c)
y.create.l HWIO_SPMI_MAPPING_TABLE_REG4_ADDR A:(&baseOffset+0x200ab10)
y.create.l HWIO_SPMI_MAPPING_TABLE_REG5_ADDR A:(&baseOffset+0x200ab14)
y.create.l HWIO_SPMI_MAPPING_TABLE_REG6_ADDR A:(&baseOffset+0x200ab18)
y.create.l HWIO_SPMI_MAPPING_TABLE_REG7_ADDR A:(&baseOffset+0x200ab1c)
y.create.l HWIO_SPMI_MAPPING_TABLE_REG8_ADDR A:(&baseOffset+0x200ab20)
y.create.l HWIO_SPMI_MAPPING_TABLE_REG9_ADDR A:(&baseOffset+0x200ab24)
y.create.l HWIO_SPMI_MID_REG_ADDR A:(&baseOffset+0x200af00)
y.create.l HWIO_SPMI_CFG_REG_ADDR A:(&baseOffset+0x200af04)
y.create.l HWIO_SPMI_SEC_DISABLE_REG_ADDR A:(&baseOffset+0x200af08)
y.create.l HWIO_SPMI_HW_VERSION_ADDR A:(&baseOffset+0x200af0c)
y.create.l HWIO_SPMI_CGC_CTRL_ADDR A:(&baseOffset+0x200af10)
y.create.l HWIO_SPMI_MWB_ENABLE_REG_ADDR A:(&baseOffset+0x200af14)
y.create.l HWIO_SPMI_CHAR_CFG_ADDR A:(&baseOffset+0x200af40)
y.create.l HWIO_SPMI_CHAR_DATA_0_ADDR A:(&baseOffset+0x200af44)
y.create.l HWIO_SPMI_CHAR_DATA_1_ADDR A:(&baseOffset+0x200af48)
y.create.l HWIO_SPMI_CMPR_EN_REG_ADDR A:(&baseOffset+0x200af54)
y.create.l HWIO_SPMI_PROTOCOL_IRQ_STATUS_ADDR A:(&baseOffset+0x200b000)
y.create.l HWIO_SPMI_PROTOCOL_IRQ_ENABLE_ADDR A:(&baseOffset+0x200b004)
y.create.l HWIO_SPMI_PROTOCOL_IRQ_CLEAR_ADDR A:(&baseOffset+0x200b008)
y.create.l HWIO_SPMI_PROTOCOL_IRQ_EN_SET_ADDR A:(&baseOffset+0x200b00c)
y.create.l HWIO_SPMI_PROTOCOL_IRQ_EN_CLEAR_ADDR A:(&baseOffset+0x200b010)
y.create.l HWIO_SPMI_TEST_BUS_CTRL_ADDR A:(&baseOffset+0x200c000)
y.create.l HWIO_SPMI_HW_SW_EVENTS_CTRL_ADDR A:(&baseOffset+0x200c004)
y.create.l HWIO_SPMI_HW_SW_EVENTS_BITWISE_REG0_ADDR A:(&baseOffset+0x200c008)
y.create.l HWIO_SPMI_HW_SW_EVENTS_BITWISE_REG1_ADDR A:(&baseOffset+0x200c00c)
y.create.l HWIO_SPMI_HW_SW_EVENTS_BITWISE_REG2_ADDR A:(&baseOffset+0x200c010)
y.create.l HWIO_SPMI_HW_SW_EVENTS_BITWISE_REG3_ADDR A:(&baseOffset+0x200c014)
y.create.l HWIO_SPMI_HW_SW_EVENTS_BITWISE_REG4_ADDR A:(&baseOffset+0x200c018)
y.create.l HWIO_SPMI_HW_SW_EVENTS_BITWISE_REG5_ADDR A:(&baseOffset+0x200c01c)
y.create.l HWIO_SPMI_HW_SW_EVENTS_BITWISE_REG6_ADDR A:(&baseOffset+0x200c020)
y.create.l HWIO_SPMI_HW_SW_EVENTS_BITWISE_REG7_ADDR A:(&baseOffset+0x200c024)
y.create.l HWIO_SPMI_PIC_OWNER0_ACC_STATUS0_ADDR A:(&baseOffset+0x3900000)
y.create.l HWIO_SPMI_PIC_OWNER1_ACC_STATUS0_ADDR A:(&baseOffset+0x3901000)
y.create.l HWIO_SPMI_PIC_OWNER2_ACC_STATUS0_ADDR A:(&baseOffset+0x3902000)
y.create.l HWIO_SPMI_PIC_OWNER3_ACC_STATUS0_ADDR A:(&baseOffset+0x3903000)
y.create.l HWIO_SPMI_PIC_OWNER0_ACC_STATUS1_ADDR A:(&baseOffset+0x3900004)
y.create.l HWIO_SPMI_PIC_OWNER1_ACC_STATUS1_ADDR A:(&baseOffset+0x3901004)
y.create.l HWIO_SPMI_PIC_OWNER2_ACC_STATUS1_ADDR A:(&baseOffset+0x3902004)
y.create.l HWIO_SPMI_PIC_OWNER3_ACC_STATUS1_ADDR A:(&baseOffset+0x3903004)
y.create.l HWIO_SPMI_PIC_OWNER0_ACC_STATUS2_ADDR A:(&baseOffset+0x3900008)
y.create.l HWIO_SPMI_PIC_OWNER1_ACC_STATUS2_ADDR A:(&baseOffset+0x3901008)
y.create.l HWIO_SPMI_PIC_OWNER2_ACC_STATUS2_ADDR A:(&baseOffset+0x3902008)
y.create.l HWIO_SPMI_PIC_OWNER3_ACC_STATUS2_ADDR A:(&baseOffset+0x3903008)
y.create.l HWIO_SPMI_PIC_OWNER0_ACC_STATUS3_ADDR A:(&baseOffset+0x390000c)
y.create.l HWIO_SPMI_PIC_OWNER1_ACC_STATUS3_ADDR A:(&baseOffset+0x390100c)
y.create.l HWIO_SPMI_PIC_OWNER2_ACC_STATUS3_ADDR A:(&baseOffset+0x390200c)
y.create.l HWIO_SPMI_PIC_OWNER3_ACC_STATUS3_ADDR A:(&baseOffset+0x390300c)
y.create.l HWIO_SPMI_PIC_ACC_ENABLE0_ADDR A:(&baseOffset+0x3800000)
y.create.l HWIO_SPMI_PIC_ACC_ENABLE1_ADDR A:(&baseOffset+0x3801000)
y.create.l HWIO_SPMI_PIC_ACC_ENABLE2_ADDR A:(&baseOffset+0x3802000)
y.create.l HWIO_SPMI_PIC_ACC_ENABLE3_ADDR A:(&baseOffset+0x3803000)
y.create.l HWIO_SPMI_PIC_ACC_ENABLE4_ADDR A:(&baseOffset+0x3804000)
y.create.l HWIO_SPMI_PIC_ACC_ENABLE5_ADDR A:(&baseOffset+0x3805000)
y.create.l HWIO_SPMI_PIC_ACC_ENABLE6_ADDR A:(&baseOffset+0x3806000)
y.create.l HWIO_SPMI_PIC_ACC_ENABLE7_ADDR A:(&baseOffset+0x3807000)
y.create.l HWIO_SPMI_PIC_ACC_ENABLE8_ADDR A:(&baseOffset+0x3808000)
y.create.l HWIO_SPMI_PIC_ACC_ENABLE9_ADDR A:(&baseOffset+0x3809000)
y.create.l HWIO_SPMI_PIC_IRQ_STATUS0_ADDR A:(&baseOffset+0x3800004)
y.create.l HWIO_SPMI_PIC_IRQ_STATUS1_ADDR A:(&baseOffset+0x3801004)
y.create.l HWIO_SPMI_PIC_IRQ_STATUS2_ADDR A:(&baseOffset+0x3802004)
y.create.l HWIO_SPMI_PIC_IRQ_STATUS3_ADDR A:(&baseOffset+0x3803004)
y.create.l HWIO_SPMI_PIC_IRQ_STATUS4_ADDR A:(&baseOffset+0x3804004)
y.create.l HWIO_SPMI_PIC_IRQ_STATUS5_ADDR A:(&baseOffset+0x3805004)
y.create.l HWIO_SPMI_PIC_IRQ_STATUS6_ADDR A:(&baseOffset+0x3806004)
y.create.l HWIO_SPMI_PIC_IRQ_STATUS7_ADDR A:(&baseOffset+0x3807004)
y.create.l HWIO_SPMI_PIC_IRQ_STATUS8_ADDR A:(&baseOffset+0x3808004)
y.create.l HWIO_SPMI_PIC_IRQ_STATUS9_ADDR A:(&baseOffset+0x3809004)
y.create.l HWIO_SPMI_PIC_IRQ_CLEAR0_ADDR A:(&baseOffset+0x3800008)
y.create.l HWIO_SPMI_PIC_IRQ_CLEAR1_ADDR A:(&baseOffset+0x3801008)
y.create.l HWIO_SPMI_PIC_IRQ_CLEAR2_ADDR A:(&baseOffset+0x3802008)
y.create.l HWIO_SPMI_PIC_IRQ_CLEAR3_ADDR A:(&baseOffset+0x3803008)
y.create.l HWIO_SPMI_PIC_IRQ_CLEAR4_ADDR A:(&baseOffset+0x3804008)
y.create.l HWIO_SPMI_PIC_IRQ_CLEAR5_ADDR A:(&baseOffset+0x3805008)
y.create.l HWIO_SPMI_PIC_IRQ_CLEAR6_ADDR A:(&baseOffset+0x3806008)
y.create.l HWIO_SPMI_PIC_IRQ_CLEAR7_ADDR A:(&baseOffset+0x3807008)
y.create.l HWIO_SPMI_PIC_IRQ_CLEAR8_ADDR A:(&baseOffset+0x3808008)
y.create.l HWIO_SPMI_PIC_IRQ_CLEAR9_ADDR A:(&baseOffset+0x3809008)
y.create.l HWIO_PMIC_ARB_XPU_SCR_ADDR A:(&baseOffset+0x200e000)
y.create.l HWIO_PMIC_ARB_XPU_SWDR_ADDR A:(&baseOffset+0x200e004)
y.create.l HWIO_PMIC_ARB_XPU_PRTN_RACR_SSHADOW_ADDR A:(&baseOffset+0x200e008)
y.create.l HWIO_PMIC_ARB_XPU_PRTN_WACR_SSHADOW_ADDR A:(&baseOffset+0x200e00c)
y.create.l HWIO_PMIC_ARB_XPU_PRTN_START_SSHADOW0_ADDR A:(&baseOffset+0x200e010)
y.create.l HWIO_PMIC_ARB_XPU_PRTN_END_SSHADOW0_ADDR A:(&baseOffset+0x200e018)
y.create.l HWIO_PMIC_ARB_XPU_SEAR0_ADDR A:(&baseOffset+0x200e040)
y.create.l HWIO_PMIC_ARB_XPU_SESR_ADDR A:(&baseOffset+0x200e048)
y.create.l HWIO_PMIC_ARB_XPU_SESRRESTORE_ADDR A:(&baseOffset+0x200e04c)
y.create.l HWIO_PMIC_ARB_XPU_SESYNR0_ADDR A:(&baseOffset+0x200e050)
y.create.l HWIO_PMIC_ARB_XPU_SESYNR1_ADDR A:(&baseOffset+0x200e054)
y.create.l HWIO_PMIC_ARB_XPU_SESYNR2_ADDR A:(&baseOffset+0x200e058)
y.create.l HWIO_PMIC_ARB_XPU_MCR_ADDR A:(&baseOffset+0x200e100)
y.create.l HWIO_PMIC_ARB_XPU_MEAR0_ADDR A:(&baseOffset+0x200e140)
y.create.l HWIO_PMIC_ARB_XPU_MESR_ADDR A:(&baseOffset+0x200e148)
y.create.l HWIO_PMIC_ARB_XPU_MESRRESTORE_ADDR A:(&baseOffset+0x200e14c)
y.create.l HWIO_PMIC_ARB_XPU_MESYNR0_ADDR A:(&baseOffset+0x200e150)
y.create.l HWIO_PMIC_ARB_XPU_MESYNR1_ADDR A:(&baseOffset+0x200e154)
y.create.l HWIO_PMIC_ARB_XPU_MESYNR2_ADDR A:(&baseOffset+0x200e158)
y.create.l HWIO_PMIC_ARB_XPU_CR_ADDR A:(&baseOffset+0x200e080)
y.create.l HWIO_PMIC_ARB_XPU_PRTN_RACR_SHADOW_ADDR A:(&baseOffset+0x200e088)
y.create.l HWIO_PMIC_ARB_XPU_PRTN_WACR_SHADOW_ADDR A:(&baseOffset+0x200e08c)
y.create.l HWIO_PMIC_ARB_XPU_PRTN_START_SHADOW0_ADDR A:(&baseOffset+0x200e090)
y.create.l HWIO_PMIC_ARB_XPU_PRTN_END_SHADOW0_ADDR A:(&baseOffset+0x200e098)
y.create.l HWIO_PMIC_ARB_XPU_RPU_ACR0_ADDR A:(&baseOffset+0x200e0a0)
y.create.l HWIO_PMIC_ARB_XPU_EAR0_ADDR A:(&baseOffset+0x200e0c0)
y.create.l HWIO_PMIC_ARB_XPU_ESR_ADDR A:(&baseOffset+0x200e0c8)
y.create.l HWIO_PMIC_ARB_XPU_ESRRESTORE_ADDR A:(&baseOffset+0x200e0cc)
y.create.l HWIO_PMIC_ARB_XPU_ESYNR0_ADDR A:(&baseOffset+0x200e0d0)
y.create.l HWIO_PMIC_ARB_XPU_ESYNR1_ADDR A:(&baseOffset+0x200e0d4)
y.create.l HWIO_PMIC_ARB_XPU_ESYNR2_ADDR A:(&baseOffset+0x200e0d8)
y.create.l HWIO_PMIC_ARB_XPU_UMR_RACR_ADDR A:(&baseOffset+0x200e0e0)
y.create.l HWIO_PMIC_ARB_XPU_UMR_WACR_ADDR A:(&baseOffset+0x200e0e4)
y.create.l HWIO_PMIC_ARB_XPU_UMR_CNTL_ADDR A:(&baseOffset+0x200e0f0)
y.create.l HWIO_PMIC_ARB_XPU_IDR0_ADDR A:(&baseOffset+0x200e074)
y.create.l HWIO_PMIC_ARB_XPU_IDR1_ADDR A:(&baseOffset+0x200e078)
y.create.l HWIO_PMIC_ARB_XPU_REV_ADDR A:(&baseOffset+0x200e07c)
y.create.l HWIO_PMIC_ARB_XPU_PRT0_RACR0_ADDR A:(&baseOffset+0x200e200)
y.create.l HWIO_PMIC_ARB_XPU_PRT1_RACR0_ADDR A:(&baseOffset+0x200e280)
y.create.l HWIO_PMIC_ARB_XPU_PRT2_RACR0_ADDR A:(&baseOffset+0x200e300)
y.create.l HWIO_PMIC_ARB_XPU_PRT3_RACR0_ADDR A:(&baseOffset+0x200e380)
y.create.l HWIO_PMIC_ARB_XPU_PRT4_RACR0_ADDR A:(&baseOffset+0x200e400)
y.create.l HWIO_PMIC_ARB_XPU_PRT5_RACR0_ADDR A:(&baseOffset+0x200e480)
y.create.l HWIO_PMIC_ARB_XPU_PRT6_RACR0_ADDR A:(&baseOffset+0x200e500)
y.create.l HWIO_PMIC_ARB_XPU_PRT7_RACR0_ADDR A:(&baseOffset+0x200e580)
y.create.l HWIO_PMIC_ARB_XPU_PRT8_RACR0_ADDR A:(&baseOffset+0x200e600)
y.create.l HWIO_PMIC_ARB_XPU_PRT9_RACR0_ADDR A:(&baseOffset+0x200e680)
y.create.l HWIO_PMIC_ARB_XPU_PRT0_WACR0_ADDR A:(&baseOffset+0x200e220)
y.create.l HWIO_PMIC_ARB_XPU_PRT1_WACR0_ADDR A:(&baseOffset+0x200e2a0)
y.create.l HWIO_PMIC_ARB_XPU_PRT2_WACR0_ADDR A:(&baseOffset+0x200e320)
y.create.l HWIO_PMIC_ARB_XPU_PRT3_WACR0_ADDR A:(&baseOffset+0x200e3a0)
y.create.l HWIO_PMIC_ARB_XPU_PRT4_WACR0_ADDR A:(&baseOffset+0x200e420)
y.create.l HWIO_PMIC_ARB_XPU_PRT5_WACR0_ADDR A:(&baseOffset+0x200e4a0)
y.create.l HWIO_PMIC_ARB_XPU_PRT6_WACR0_ADDR A:(&baseOffset+0x200e520)
y.create.l HWIO_PMIC_ARB_XPU_PRT7_WACR0_ADDR A:(&baseOffset+0x200e5a0)
y.create.l HWIO_PMIC_ARB_XPU_PRT8_WACR0_ADDR A:(&baseOffset+0x200e620)
y.create.l HWIO_PMIC_ARB_XPU_PRT9_WACR0_ADDR A:(&baseOffset+0x200e6a0)
y.create.l HWIO_PMIC_ARB_XPU_PRT0_START0_ADDR A:(&baseOffset+0x200e240)
y.create.l HWIO_PMIC_ARB_XPU_PRT1_START0_ADDR A:(&baseOffset+0x200e2c0)
y.create.l HWIO_PMIC_ARB_XPU_PRT2_START0_ADDR A:(&baseOffset+0x200e340)
y.create.l HWIO_PMIC_ARB_XPU_PRT3_START0_ADDR A:(&baseOffset+0x200e3c0)
y.create.l HWIO_PMIC_ARB_XPU_PRT4_START0_ADDR A:(&baseOffset+0x200e440)
y.create.l HWIO_PMIC_ARB_XPU_PRT5_START0_ADDR A:(&baseOffset+0x200e4c0)
y.create.l HWIO_PMIC_ARB_XPU_PRT6_START0_ADDR A:(&baseOffset+0x200e540)
y.create.l HWIO_PMIC_ARB_XPU_PRT7_START0_ADDR A:(&baseOffset+0x200e5c0)
y.create.l HWIO_PMIC_ARB_XPU_PRT8_START0_ADDR A:(&baseOffset+0x200e640)
y.create.l HWIO_PMIC_ARB_XPU_PRT9_START0_ADDR A:(&baseOffset+0x200e6c0)
y.create.l HWIO_PMIC_ARB_XPU_PRT0_END0_ADDR A:(&baseOffset+0x200e248)
y.create.l HWIO_PMIC_ARB_XPU_PRT1_END0_ADDR A:(&baseOffset+0x200e2c8)
y.create.l HWIO_PMIC_ARB_XPU_PRT2_END0_ADDR A:(&baseOffset+0x200e348)
y.create.l HWIO_PMIC_ARB_XPU_PRT3_END0_ADDR A:(&baseOffset+0x200e3c8)
y.create.l HWIO_PMIC_ARB_XPU_PRT4_END0_ADDR A:(&baseOffset+0x200e448)
y.create.l HWIO_PMIC_ARB_XPU_PRT5_END0_ADDR A:(&baseOffset+0x200e4c8)
y.create.l HWIO_PMIC_ARB_XPU_PRT6_END0_ADDR A:(&baseOffset+0x200e548)
y.create.l HWIO_PMIC_ARB_XPU_PRT7_END0_ADDR A:(&baseOffset+0x200e5c8)
y.create.l HWIO_PMIC_ARB_XPU_PRT8_END0_ADDR A:(&baseOffset+0x200e648)
y.create.l HWIO_PMIC_ARB_XPU_PRT9_END0_ADDR A:(&baseOffset+0x200e6c8)
y.create.l HWIO_PMIC_ARB_XPU_PRT0_SCR_ADDR A:(&baseOffset+0x200e250)
y.create.l HWIO_PMIC_ARB_XPU_PRT1_SCR_ADDR A:(&baseOffset+0x200e2d0)
y.create.l HWIO_PMIC_ARB_XPU_PRT2_SCR_ADDR A:(&baseOffset+0x200e350)
y.create.l HWIO_PMIC_ARB_XPU_PRT3_SCR_ADDR A:(&baseOffset+0x200e3d0)
y.create.l HWIO_PMIC_ARB_XPU_PRT4_SCR_ADDR A:(&baseOffset+0x200e450)
y.create.l HWIO_PMIC_ARB_XPU_PRT5_SCR_ADDR A:(&baseOffset+0x200e4d0)
y.create.l HWIO_PMIC_ARB_XPU_PRT6_SCR_ADDR A:(&baseOffset+0x200e550)
y.create.l HWIO_PMIC_ARB_XPU_PRT7_SCR_ADDR A:(&baseOffset+0x200e5d0)
y.create.l HWIO_PMIC_ARB_XPU_PRT8_SCR_ADDR A:(&baseOffset+0x200e650)
y.create.l HWIO_PMIC_ARB_XPU_PRT9_SCR_ADDR A:(&baseOffset+0x200e6d0)
y.create.l HWIO_PMIC_ARB_XPU_PRT0_MCR_ADDR A:(&baseOffset+0x200e254)
y.create.l HWIO_PMIC_ARB_XPU_PRT1_MCR_ADDR A:(&baseOffset+0x200e2d4)
y.create.l HWIO_PMIC_ARB_XPU_PRT2_MCR_ADDR A:(&baseOffset+0x200e354)
y.create.l HWIO_PMIC_ARB_XPU_PRT3_MCR_ADDR A:(&baseOffset+0x200e3d4)
y.create.l HWIO_PMIC_ARB_XPU_PRT4_MCR_ADDR A:(&baseOffset+0x200e454)
y.create.l HWIO_PMIC_ARB_XPU_PRT5_MCR_ADDR A:(&baseOffset+0x200e4d4)
y.create.l HWIO_PMIC_ARB_XPU_PRT6_MCR_ADDR A:(&baseOffset+0x200e554)
y.create.l HWIO_PMIC_ARB_XPU_PRT7_MCR_ADDR A:(&baseOffset+0x200e5d4)
y.create.l HWIO_PMIC_ARB_XPU_PRT8_MCR_ADDR A:(&baseOffset+0x200e654)
y.create.l HWIO_PMIC_ARB_XPU_PRT9_MCR_ADDR A:(&baseOffset+0x200e6d4)
y.create.l HWIO_PMIC_ARB_XPU_PRT0_CNTL0_ADDR A:(&baseOffset+0x200e258)
y.create.l HWIO_PMIC_ARB_XPU_PRT1_CNTL0_ADDR A:(&baseOffset+0x200e2d8)
y.create.l HWIO_PMIC_ARB_XPU_PRT2_CNTL0_ADDR A:(&baseOffset+0x200e358)
y.create.l HWIO_PMIC_ARB_XPU_PRT3_CNTL0_ADDR A:(&baseOffset+0x200e3d8)
y.create.l HWIO_PMIC_ARB_XPU_PRT4_CNTL0_ADDR A:(&baseOffset+0x200e458)
y.create.l HWIO_PMIC_ARB_XPU_PRT5_CNTL0_ADDR A:(&baseOffset+0x200e4d8)
y.create.l HWIO_PMIC_ARB_XPU_PRT6_CNTL0_ADDR A:(&baseOffset+0x200e558)
y.create.l HWIO_PMIC_ARB_XPU_PRT7_CNTL0_ADDR A:(&baseOffset+0x200e5d8)
y.create.l HWIO_PMIC_ARB_XPU_PRT8_CNTL0_ADDR A:(&baseOffset+0x200e658)
y.create.l HWIO_PMIC_ARB_XPU_PRT9_CNTL0_ADDR A:(&baseOffset+0x200e6d8)
y.create.l HWIO_PMIC_ARB_XPU_PRT0_CNTL1_ADDR A:(&baseOffset+0x200e25c)
y.create.l HWIO_PMIC_ARB_XPU_PRT1_CNTL1_ADDR A:(&baseOffset+0x200e2dc)
y.create.l HWIO_PMIC_ARB_XPU_PRT2_CNTL1_ADDR A:(&baseOffset+0x200e35c)
y.create.l HWIO_PMIC_ARB_XPU_PRT3_CNTL1_ADDR A:(&baseOffset+0x200e3dc)
y.create.l HWIO_PMIC_ARB_XPU_PRT4_CNTL1_ADDR A:(&baseOffset+0x200e45c)
y.create.l HWIO_PMIC_ARB_XPU_PRT5_CNTL1_ADDR A:(&baseOffset+0x200e4dc)
y.create.l HWIO_PMIC_ARB_XPU_PRT6_CNTL1_ADDR A:(&baseOffset+0x200e55c)
y.create.l HWIO_PMIC_ARB_XPU_PRT7_CNTL1_ADDR A:(&baseOffset+0x200e5dc)
y.create.l HWIO_PMIC_ARB_XPU_PRT8_CNTL1_ADDR A:(&baseOffset+0x200e65c)
y.create.l HWIO_PMIC_ARB_XPU_PRT9_CNTL1_ADDR A:(&baseOffset+0x200e6dc)
y.create.l HWIO_PMIC_ARB_HW_VERSION_ADDR A:(&baseOffset+0x200f000)
y.create.l HWIO_PMIC_ARB_MISC_CONFIG_ADDR A:(&baseOffset+0x200f004)
y.create.l HWIO_PMIC_ARB_PVC_INTF_CTL_ADDR A:(&baseOffset+0x200f008)
y.create.l HWIO_PMIC_ARB_PVC_INTF_STATUS_ADDR A:(&baseOffset+0x200f00c)
y.create.l HWIO_PMIC_ARB_PRIORITIES0_ADDR A:(&baseOffset+0x200f100)
y.create.l HWIO_PMIC_ARB_PRIORITIES1_ADDR A:(&baseOffset+0x200f104)
y.create.l HWIO_PMIC_ARB_PRIORITIES2_ADDR A:(&baseOffset+0x200f108)
y.create.l HWIO_PMIC_ARB_PRIORITIES3_ADDR A:(&baseOffset+0x200f10c)
y.create.l HWIO_PMIC_ARB_PRIORITIES4_ADDR A:(&baseOffset+0x200f110)
y.create.l HWIO_PMIC_ARB_PRIORITIES5_ADDR A:(&baseOffset+0x200f114)
y.create.l HWIO_PMIC_ARB_PVC_PORT0_CTL_ADDR A:(&baseOffset+0x200f200)
y.create.l HWIO_PMIC_ARB_PVC_PORT1_CTL_ADDR A:(&baseOffset+0x200f204)
y.create.l HWIO_PMIC_ARB_PVC_PORT2_CTL_ADDR A:(&baseOffset+0x200f208)
y.create.l HWIO_PMIC_ARB_PVC_PORT3_CTL_ADDR A:(&baseOffset+0x200f20c)
y.create.l HWIO_PMIC_ARB_PVC_PORT4_CTL_ADDR A:(&baseOffset+0x200f210)
y.create.l HWIO_PMIC_ARB_PVC_PORT0_STATUS_ADDR A:(&baseOffset+0x200f280)
y.create.l HWIO_PMIC_ARB_PVC_PORT1_STATUS_ADDR A:(&baseOffset+0x200f284)
y.create.l HWIO_PMIC_ARB_PVC_PORT2_STATUS_ADDR A:(&baseOffset+0x200f288)
y.create.l HWIO_PMIC_ARB_PVC_PORT3_STATUS_ADDR A:(&baseOffset+0x200f28c)
y.create.l HWIO_PMIC_ARB_PVC_PORT4_STATUS_ADDR A:(&baseOffset+0x200f290)
y.create.l HWIO_PMIC_ARB_PVC0_ADDR0_ADDR A:(&baseOffset+0x200f400)
y.create.l HWIO_PMIC_ARB_PVC1_ADDR0_ADDR A:(&baseOffset+0x200f420)
y.create.l HWIO_PMIC_ARB_PVC2_ADDR0_ADDR A:(&baseOffset+0x200f440)
y.create.l HWIO_PMIC_ARB_PVC3_ADDR0_ADDR A:(&baseOffset+0x200f460)
y.create.l HWIO_PMIC_ARB_PVC0_ADDR1_ADDR A:(&baseOffset+0x200f404)
y.create.l HWIO_PMIC_ARB_PVC1_ADDR1_ADDR A:(&baseOffset+0x200f424)
y.create.l HWIO_PMIC_ARB_PVC2_ADDR1_ADDR A:(&baseOffset+0x200f444)
y.create.l HWIO_PMIC_ARB_PVC3_ADDR1_ADDR A:(&baseOffset+0x200f464)
y.create.l HWIO_PMIC_ARB_PVC0_ADDR2_ADDR A:(&baseOffset+0x200f408)
y.create.l HWIO_PMIC_ARB_PVC1_ADDR2_ADDR A:(&baseOffset+0x200f428)
y.create.l HWIO_PMIC_ARB_PVC2_ADDR2_ADDR A:(&baseOffset+0x200f448)
y.create.l HWIO_PMIC_ARB_PVC3_ADDR2_ADDR A:(&baseOffset+0x200f468)
y.create.l HWIO_PMIC_ARB_PVC0_ADDR3_ADDR A:(&baseOffset+0x200f40c)
y.create.l HWIO_PMIC_ARB_PVC1_ADDR3_ADDR A:(&baseOffset+0x200f42c)
y.create.l HWIO_PMIC_ARB_PVC2_ADDR3_ADDR A:(&baseOffset+0x200f44c)
y.create.l HWIO_PMIC_ARB_PVC3_ADDR3_ADDR A:(&baseOffset+0x200f46c)
y.create.l HWIO_PMIC_ARB_REG_CHNL0_ADDR A:(&baseOffset+0x200f800)
y.create.l HWIO_PMIC_ARB_REG_CHNL1_ADDR A:(&baseOffset+0x200f804)
y.create.l HWIO_PMIC_ARB_REG_CHNL2_ADDR A:(&baseOffset+0x200f808)
y.create.l HWIO_PMIC_ARB_REG_CHNL3_ADDR A:(&baseOffset+0x200f80c)
y.create.l HWIO_PMIC_ARB_REG_CHNL4_ADDR A:(&baseOffset+0x200f810)
y.create.l HWIO_PMIC_ARB_REG_CHNL5_ADDR A:(&baseOffset+0x200f814)
y.create.l HWIO_PMIC_ARB_REG_CHNL6_ADDR A:(&baseOffset+0x200f818)
y.create.l HWIO_PMIC_ARB_REG_CHNL7_ADDR A:(&baseOffset+0x200f81c)
y.create.l HWIO_PMIC_ARB_REG_CHNL8_ADDR A:(&baseOffset+0x200f820)
y.create.l HWIO_PMIC_ARB_REG_CHNL9_ADDR A:(&baseOffset+0x200f824)
y.create.l HWIO_PMIC_ARB0_CHNL0_CMD_ADDR A:(&baseOffset+0x2400000)
y.create.l HWIO_PMIC_ARB1_CHNL0_CMD_ADDR A:(&baseOffset+0x2401000)
y.create.l HWIO_PMIC_ARB2_CHNL0_CMD_ADDR A:(&baseOffset+0x2402000)
y.create.l HWIO_PMIC_ARB3_CHNL0_CMD_ADDR A:(&baseOffset+0x2403000)
y.create.l HWIO_PMIC_ARB0_CHNL1_CMD_ADDR A:(&baseOffset+0x2408000)
y.create.l HWIO_PMIC_ARB1_CHNL1_CMD_ADDR A:(&baseOffset+0x2409000)
y.create.l HWIO_PMIC_ARB2_CHNL1_CMD_ADDR A:(&baseOffset+0x240a000)
y.create.l HWIO_PMIC_ARB3_CHNL1_CMD_ADDR A:(&baseOffset+0x240b000)
y.create.l HWIO_PMIC_ARB0_CHNL2_CMD_ADDR A:(&baseOffset+0x2410000)
y.create.l HWIO_PMIC_ARB1_CHNL2_CMD_ADDR A:(&baseOffset+0x2411000)
y.create.l HWIO_PMIC_ARB2_CHNL2_CMD_ADDR A:(&baseOffset+0x2412000)
y.create.l HWIO_PMIC_ARB3_CHNL2_CMD_ADDR A:(&baseOffset+0x2413000)
y.create.l HWIO_PMIC_ARB0_CHNL3_CMD_ADDR A:(&baseOffset+0x2418000)
y.create.l HWIO_PMIC_ARB1_CHNL3_CMD_ADDR A:(&baseOffset+0x2419000)
y.create.l HWIO_PMIC_ARB2_CHNL3_CMD_ADDR A:(&baseOffset+0x241a000)
y.create.l HWIO_PMIC_ARB3_CHNL3_CMD_ADDR A:(&baseOffset+0x241b000)
y.create.l HWIO_PMIC_ARB0_CHNL4_CMD_ADDR A:(&baseOffset+0x2420000)
y.create.l HWIO_PMIC_ARB1_CHNL4_CMD_ADDR A:(&baseOffset+0x2421000)
y.create.l HWIO_PMIC_ARB2_CHNL4_CMD_ADDR A:(&baseOffset+0x2422000)
y.create.l HWIO_PMIC_ARB3_CHNL4_CMD_ADDR A:(&baseOffset+0x2423000)
y.create.l HWIO_PMIC_ARB0_CHNL5_CMD_ADDR A:(&baseOffset+0x2428000)
y.create.l HWIO_PMIC_ARB1_CHNL5_CMD_ADDR A:(&baseOffset+0x2429000)
y.create.l HWIO_PMIC_ARB2_CHNL5_CMD_ADDR A:(&baseOffset+0x242a000)
y.create.l HWIO_PMIC_ARB3_CHNL5_CMD_ADDR A:(&baseOffset+0x242b000)
y.create.l HWIO_PMIC_ARB0_CHNL6_CMD_ADDR A:(&baseOffset+0x2430000)
y.create.l HWIO_PMIC_ARB1_CHNL6_CMD_ADDR A:(&baseOffset+0x2431000)
y.create.l HWIO_PMIC_ARB2_CHNL6_CMD_ADDR A:(&baseOffset+0x2432000)
y.create.l HWIO_PMIC_ARB3_CHNL6_CMD_ADDR A:(&baseOffset+0x2433000)
y.create.l HWIO_PMIC_ARB0_CHNL7_CMD_ADDR A:(&baseOffset+0x2438000)
y.create.l HWIO_PMIC_ARB1_CHNL7_CMD_ADDR A:(&baseOffset+0x2439000)
y.create.l HWIO_PMIC_ARB2_CHNL7_CMD_ADDR A:(&baseOffset+0x243a000)
y.create.l HWIO_PMIC_ARB3_CHNL7_CMD_ADDR A:(&baseOffset+0x243b000)
y.create.l HWIO_PMIC_ARB0_CHNL8_CMD_ADDR A:(&baseOffset+0x2440000)
y.create.l HWIO_PMIC_ARB1_CHNL8_CMD_ADDR A:(&baseOffset+0x2441000)
y.create.l HWIO_PMIC_ARB2_CHNL8_CMD_ADDR A:(&baseOffset+0x2442000)
y.create.l HWIO_PMIC_ARB3_CHNL8_CMD_ADDR A:(&baseOffset+0x2443000)
y.create.l HWIO_PMIC_ARB0_CHNL9_CMD_ADDR A:(&baseOffset+0x2448000)
y.create.l HWIO_PMIC_ARB1_CHNL9_CMD_ADDR A:(&baseOffset+0x2449000)
y.create.l HWIO_PMIC_ARB2_CHNL9_CMD_ADDR A:(&baseOffset+0x244a000)
y.create.l HWIO_PMIC_ARB3_CHNL9_CMD_ADDR A:(&baseOffset+0x244b000)
y.create.l HWIO_PMIC_ARB0_CHNL0_CONFIG_ADDR A:(&baseOffset+0x2400004)
y.create.l HWIO_PMIC_ARB1_CHNL0_CONFIG_ADDR A:(&baseOffset+0x2401004)
y.create.l HWIO_PMIC_ARB2_CHNL0_CONFIG_ADDR A:(&baseOffset+0x2402004)
y.create.l HWIO_PMIC_ARB3_CHNL0_CONFIG_ADDR A:(&baseOffset+0x2403004)
y.create.l HWIO_PMIC_ARB0_CHNL1_CONFIG_ADDR A:(&baseOffset+0x2408004)
y.create.l HWIO_PMIC_ARB1_CHNL1_CONFIG_ADDR A:(&baseOffset+0x2409004)
y.create.l HWIO_PMIC_ARB2_CHNL1_CONFIG_ADDR A:(&baseOffset+0x240a004)
y.create.l HWIO_PMIC_ARB3_CHNL1_CONFIG_ADDR A:(&baseOffset+0x240b004)
y.create.l HWIO_PMIC_ARB0_CHNL2_CONFIG_ADDR A:(&baseOffset+0x2410004)
y.create.l HWIO_PMIC_ARB1_CHNL2_CONFIG_ADDR A:(&baseOffset+0x2411004)
y.create.l HWIO_PMIC_ARB2_CHNL2_CONFIG_ADDR A:(&baseOffset+0x2412004)
y.create.l HWIO_PMIC_ARB3_CHNL2_CONFIG_ADDR A:(&baseOffset+0x2413004)
y.create.l HWIO_PMIC_ARB0_CHNL3_CONFIG_ADDR A:(&baseOffset+0x2418004)
y.create.l HWIO_PMIC_ARB1_CHNL3_CONFIG_ADDR A:(&baseOffset+0x2419004)
y.create.l HWIO_PMIC_ARB2_CHNL3_CONFIG_ADDR A:(&baseOffset+0x241a004)
y.create.l HWIO_PMIC_ARB3_CHNL3_CONFIG_ADDR A:(&baseOffset+0x241b004)
y.create.l HWIO_PMIC_ARB0_CHNL4_CONFIG_ADDR A:(&baseOffset+0x2420004)
y.create.l HWIO_PMIC_ARB1_CHNL4_CONFIG_ADDR A:(&baseOffset+0x2421004)
y.create.l HWIO_PMIC_ARB2_CHNL4_CONFIG_ADDR A:(&baseOffset+0x2422004)
y.create.l HWIO_PMIC_ARB3_CHNL4_CONFIG_ADDR A:(&baseOffset+0x2423004)
y.create.l HWIO_PMIC_ARB0_CHNL5_CONFIG_ADDR A:(&baseOffset+0x2428004)
y.create.l HWIO_PMIC_ARB1_CHNL5_CONFIG_ADDR A:(&baseOffset+0x2429004)
y.create.l HWIO_PMIC_ARB2_CHNL5_CONFIG_ADDR A:(&baseOffset+0x242a004)
y.create.l HWIO_PMIC_ARB3_CHNL5_CONFIG_ADDR A:(&baseOffset+0x242b004)
y.create.l HWIO_PMIC_ARB0_CHNL6_CONFIG_ADDR A:(&baseOffset+0x2430004)
y.create.l HWIO_PMIC_ARB1_CHNL6_CONFIG_ADDR A:(&baseOffset+0x2431004)
y.create.l HWIO_PMIC_ARB2_CHNL6_CONFIG_ADDR A:(&baseOffset+0x2432004)
y.create.l HWIO_PMIC_ARB3_CHNL6_CONFIG_ADDR A:(&baseOffset+0x2433004)
y.create.l HWIO_PMIC_ARB0_CHNL7_CONFIG_ADDR A:(&baseOffset+0x2438004)
y.create.l HWIO_PMIC_ARB1_CHNL7_CONFIG_ADDR A:(&baseOffset+0x2439004)
y.create.l HWIO_PMIC_ARB2_CHNL7_CONFIG_ADDR A:(&baseOffset+0x243a004)
y.create.l HWIO_PMIC_ARB3_CHNL7_CONFIG_ADDR A:(&baseOffset+0x243b004)
y.create.l HWIO_PMIC_ARB0_CHNL8_CONFIG_ADDR A:(&baseOffset+0x2440004)
y.create.l HWIO_PMIC_ARB1_CHNL8_CONFIG_ADDR A:(&baseOffset+0x2441004)
y.create.l HWIO_PMIC_ARB2_CHNL8_CONFIG_ADDR A:(&baseOffset+0x2442004)
y.create.l HWIO_PMIC_ARB3_CHNL8_CONFIG_ADDR A:(&baseOffset+0x2443004)
y.create.l HWIO_PMIC_ARB0_CHNL9_CONFIG_ADDR A:(&baseOffset+0x2448004)
y.create.l HWIO_PMIC_ARB1_CHNL9_CONFIG_ADDR A:(&baseOffset+0x2449004)
y.create.l HWIO_PMIC_ARB2_CHNL9_CONFIG_ADDR A:(&baseOffset+0x244a004)
y.create.l HWIO_PMIC_ARB3_CHNL9_CONFIG_ADDR A:(&baseOffset+0x244b004)
y.create.l HWIO_PMIC_ARB0_CHNL0_STATUS_ADDR A:(&baseOffset+0x2400008)
y.create.l HWIO_PMIC_ARB1_CHNL0_STATUS_ADDR A:(&baseOffset+0x2401008)
y.create.l HWIO_PMIC_ARB2_CHNL0_STATUS_ADDR A:(&baseOffset+0x2402008)
y.create.l HWIO_PMIC_ARB3_CHNL0_STATUS_ADDR A:(&baseOffset+0x2403008)
y.create.l HWIO_PMIC_ARB0_CHNL1_STATUS_ADDR A:(&baseOffset+0x2408008)
y.create.l HWIO_PMIC_ARB1_CHNL1_STATUS_ADDR A:(&baseOffset+0x2409008)
y.create.l HWIO_PMIC_ARB2_CHNL1_STATUS_ADDR A:(&baseOffset+0x240a008)
y.create.l HWIO_PMIC_ARB3_CHNL1_STATUS_ADDR A:(&baseOffset+0x240b008)
y.create.l HWIO_PMIC_ARB0_CHNL2_STATUS_ADDR A:(&baseOffset+0x2410008)
y.create.l HWIO_PMIC_ARB1_CHNL2_STATUS_ADDR A:(&baseOffset+0x2411008)
y.create.l HWIO_PMIC_ARB2_CHNL2_STATUS_ADDR A:(&baseOffset+0x2412008)
y.create.l HWIO_PMIC_ARB3_CHNL2_STATUS_ADDR A:(&baseOffset+0x2413008)
y.create.l HWIO_PMIC_ARB0_CHNL3_STATUS_ADDR A:(&baseOffset+0x2418008)
y.create.l HWIO_PMIC_ARB1_CHNL3_STATUS_ADDR A:(&baseOffset+0x2419008)
y.create.l HWIO_PMIC_ARB2_CHNL3_STATUS_ADDR A:(&baseOffset+0x241a008)
y.create.l HWIO_PMIC_ARB3_CHNL3_STATUS_ADDR A:(&baseOffset+0x241b008)
y.create.l HWIO_PMIC_ARB0_CHNL4_STATUS_ADDR A:(&baseOffset+0x2420008)
y.create.l HWIO_PMIC_ARB1_CHNL4_STATUS_ADDR A:(&baseOffset+0x2421008)
y.create.l HWIO_PMIC_ARB2_CHNL4_STATUS_ADDR A:(&baseOffset+0x2422008)
y.create.l HWIO_PMIC_ARB3_CHNL4_STATUS_ADDR A:(&baseOffset+0x2423008)
y.create.l HWIO_PMIC_ARB0_CHNL5_STATUS_ADDR A:(&baseOffset+0x2428008)
y.create.l HWIO_PMIC_ARB1_CHNL5_STATUS_ADDR A:(&baseOffset+0x2429008)
y.create.l HWIO_PMIC_ARB2_CHNL5_STATUS_ADDR A:(&baseOffset+0x242a008)
y.create.l HWIO_PMIC_ARB3_CHNL5_STATUS_ADDR A:(&baseOffset+0x242b008)
y.create.l HWIO_PMIC_ARB0_CHNL6_STATUS_ADDR A:(&baseOffset+0x2430008)
y.create.l HWIO_PMIC_ARB1_CHNL6_STATUS_ADDR A:(&baseOffset+0x2431008)
y.create.l HWIO_PMIC_ARB2_CHNL6_STATUS_ADDR A:(&baseOffset+0x2432008)
y.create.l HWIO_PMIC_ARB3_CHNL6_STATUS_ADDR A:(&baseOffset+0x2433008)
y.create.l HWIO_PMIC_ARB0_CHNL7_STATUS_ADDR A:(&baseOffset+0x2438008)
y.create.l HWIO_PMIC_ARB1_CHNL7_STATUS_ADDR A:(&baseOffset+0x2439008)
y.create.l HWIO_PMIC_ARB2_CHNL7_STATUS_ADDR A:(&baseOffset+0x243a008)
y.create.l HWIO_PMIC_ARB3_CHNL7_STATUS_ADDR A:(&baseOffset+0x243b008)
y.create.l HWIO_PMIC_ARB0_CHNL8_STATUS_ADDR A:(&baseOffset+0x2440008)
y.create.l HWIO_PMIC_ARB1_CHNL8_STATUS_ADDR A:(&baseOffset+0x2441008)
y.create.l HWIO_PMIC_ARB2_CHNL8_STATUS_ADDR A:(&baseOffset+0x2442008)
y.create.l HWIO_PMIC_ARB3_CHNL8_STATUS_ADDR A:(&baseOffset+0x2443008)
y.create.l HWIO_PMIC_ARB0_CHNL9_STATUS_ADDR A:(&baseOffset+0x2448008)
y.create.l HWIO_PMIC_ARB1_CHNL9_STATUS_ADDR A:(&baseOffset+0x2449008)
y.create.l HWIO_PMIC_ARB2_CHNL9_STATUS_ADDR A:(&baseOffset+0x244a008)
y.create.l HWIO_PMIC_ARB3_CHNL9_STATUS_ADDR A:(&baseOffset+0x244b008)
y.create.l HWIO_PMIC_ARB0_CHNL0_WDATA0_ADDR A:(&baseOffset+0x2400010)
y.create.l HWIO_PMIC_ARB1_CHNL0_WDATA0_ADDR A:(&baseOffset+0x2401010)
y.create.l HWIO_PMIC_ARB2_CHNL0_WDATA0_ADDR A:(&baseOffset+0x2402010)
y.create.l HWIO_PMIC_ARB3_CHNL0_WDATA0_ADDR A:(&baseOffset+0x2403010)
y.create.l HWIO_PMIC_ARB0_CHNL1_WDATA0_ADDR A:(&baseOffset+0x2408010)
y.create.l HWIO_PMIC_ARB1_CHNL1_WDATA0_ADDR A:(&baseOffset+0x2409010)
y.create.l HWIO_PMIC_ARB2_CHNL1_WDATA0_ADDR A:(&baseOffset+0x240a010)
y.create.l HWIO_PMIC_ARB3_CHNL1_WDATA0_ADDR A:(&baseOffset+0x240b010)
y.create.l HWIO_PMIC_ARB0_CHNL2_WDATA0_ADDR A:(&baseOffset+0x2410010)
y.create.l HWIO_PMIC_ARB1_CHNL2_WDATA0_ADDR A:(&baseOffset+0x2411010)
y.create.l HWIO_PMIC_ARB2_CHNL2_WDATA0_ADDR A:(&baseOffset+0x2412010)
y.create.l HWIO_PMIC_ARB3_CHNL2_WDATA0_ADDR A:(&baseOffset+0x2413010)
y.create.l HWIO_PMIC_ARB0_CHNL3_WDATA0_ADDR A:(&baseOffset+0x2418010)
y.create.l HWIO_PMIC_ARB1_CHNL3_WDATA0_ADDR A:(&baseOffset+0x2419010)
y.create.l HWIO_PMIC_ARB2_CHNL3_WDATA0_ADDR A:(&baseOffset+0x241a010)
y.create.l HWIO_PMIC_ARB3_CHNL3_WDATA0_ADDR A:(&baseOffset+0x241b010)
y.create.l HWIO_PMIC_ARB0_CHNL4_WDATA0_ADDR A:(&baseOffset+0x2420010)
y.create.l HWIO_PMIC_ARB1_CHNL4_WDATA0_ADDR A:(&baseOffset+0x2421010)
y.create.l HWIO_PMIC_ARB2_CHNL4_WDATA0_ADDR A:(&baseOffset+0x2422010)
y.create.l HWIO_PMIC_ARB3_CHNL4_WDATA0_ADDR A:(&baseOffset+0x2423010)
y.create.l HWIO_PMIC_ARB0_CHNL5_WDATA0_ADDR A:(&baseOffset+0x2428010)
y.create.l HWIO_PMIC_ARB1_CHNL5_WDATA0_ADDR A:(&baseOffset+0x2429010)
y.create.l HWIO_PMIC_ARB2_CHNL5_WDATA0_ADDR A:(&baseOffset+0x242a010)
y.create.l HWIO_PMIC_ARB3_CHNL5_WDATA0_ADDR A:(&baseOffset+0x242b010)
y.create.l HWIO_PMIC_ARB0_CHNL6_WDATA0_ADDR A:(&baseOffset+0x2430010)
y.create.l HWIO_PMIC_ARB1_CHNL6_WDATA0_ADDR A:(&baseOffset+0x2431010)
y.create.l HWIO_PMIC_ARB2_CHNL6_WDATA0_ADDR A:(&baseOffset+0x2432010)
y.create.l HWIO_PMIC_ARB3_CHNL6_WDATA0_ADDR A:(&baseOffset+0x2433010)
y.create.l HWIO_PMIC_ARB0_CHNL7_WDATA0_ADDR A:(&baseOffset+0x2438010)
y.create.l HWIO_PMIC_ARB1_CHNL7_WDATA0_ADDR A:(&baseOffset+0x2439010)
y.create.l HWIO_PMIC_ARB2_CHNL7_WDATA0_ADDR A:(&baseOffset+0x243a010)
y.create.l HWIO_PMIC_ARB3_CHNL7_WDATA0_ADDR A:(&baseOffset+0x243b010)
y.create.l HWIO_PMIC_ARB0_CHNL8_WDATA0_ADDR A:(&baseOffset+0x2440010)
y.create.l HWIO_PMIC_ARB1_CHNL8_WDATA0_ADDR A:(&baseOffset+0x2441010)
y.create.l HWIO_PMIC_ARB2_CHNL8_WDATA0_ADDR A:(&baseOffset+0x2442010)
y.create.l HWIO_PMIC_ARB3_CHNL8_WDATA0_ADDR A:(&baseOffset+0x2443010)
y.create.l HWIO_PMIC_ARB0_CHNL9_WDATA0_ADDR A:(&baseOffset+0x2448010)
y.create.l HWIO_PMIC_ARB1_CHNL9_WDATA0_ADDR A:(&baseOffset+0x2449010)
y.create.l HWIO_PMIC_ARB2_CHNL9_WDATA0_ADDR A:(&baseOffset+0x244a010)
y.create.l HWIO_PMIC_ARB3_CHNL9_WDATA0_ADDR A:(&baseOffset+0x244b010)
y.create.l HWIO_PMIC_ARB0_CHNL0_WDATA1_ADDR A:(&baseOffset+0x2400014)
y.create.l HWIO_PMIC_ARB1_CHNL0_WDATA1_ADDR A:(&baseOffset+0x2401014)
y.create.l HWIO_PMIC_ARB2_CHNL0_WDATA1_ADDR A:(&baseOffset+0x2402014)
y.create.l HWIO_PMIC_ARB3_CHNL0_WDATA1_ADDR A:(&baseOffset+0x2403014)
y.create.l HWIO_PMIC_ARB0_CHNL1_WDATA1_ADDR A:(&baseOffset+0x2408014)
y.create.l HWIO_PMIC_ARB1_CHNL1_WDATA1_ADDR A:(&baseOffset+0x2409014)
y.create.l HWIO_PMIC_ARB2_CHNL1_WDATA1_ADDR A:(&baseOffset+0x240a014)
y.create.l HWIO_PMIC_ARB3_CHNL1_WDATA1_ADDR A:(&baseOffset+0x240b014)
y.create.l HWIO_PMIC_ARB0_CHNL2_WDATA1_ADDR A:(&baseOffset+0x2410014)
y.create.l HWIO_PMIC_ARB1_CHNL2_WDATA1_ADDR A:(&baseOffset+0x2411014)
y.create.l HWIO_PMIC_ARB2_CHNL2_WDATA1_ADDR A:(&baseOffset+0x2412014)
y.create.l HWIO_PMIC_ARB3_CHNL2_WDATA1_ADDR A:(&baseOffset+0x2413014)
y.create.l HWIO_PMIC_ARB0_CHNL3_WDATA1_ADDR A:(&baseOffset+0x2418014)
y.create.l HWIO_PMIC_ARB1_CHNL3_WDATA1_ADDR A:(&baseOffset+0x2419014)
y.create.l HWIO_PMIC_ARB2_CHNL3_WDATA1_ADDR A:(&baseOffset+0x241a014)
y.create.l HWIO_PMIC_ARB3_CHNL3_WDATA1_ADDR A:(&baseOffset+0x241b014)
y.create.l HWIO_PMIC_ARB0_CHNL4_WDATA1_ADDR A:(&baseOffset+0x2420014)
y.create.l HWIO_PMIC_ARB1_CHNL4_WDATA1_ADDR A:(&baseOffset+0x2421014)
y.create.l HWIO_PMIC_ARB2_CHNL4_WDATA1_ADDR A:(&baseOffset+0x2422014)
y.create.l HWIO_PMIC_ARB3_CHNL4_WDATA1_ADDR A:(&baseOffset+0x2423014)
y.create.l HWIO_PMIC_ARB0_CHNL5_WDATA1_ADDR A:(&baseOffset+0x2428014)
y.create.l HWIO_PMIC_ARB1_CHNL5_WDATA1_ADDR A:(&baseOffset+0x2429014)
y.create.l HWIO_PMIC_ARB2_CHNL5_WDATA1_ADDR A:(&baseOffset+0x242a014)
y.create.l HWIO_PMIC_ARB3_CHNL5_WDATA1_ADDR A:(&baseOffset+0x242b014)
y.create.l HWIO_PMIC_ARB0_CHNL6_WDATA1_ADDR A:(&baseOffset+0x2430014)
y.create.l HWIO_PMIC_ARB1_CHNL6_WDATA1_ADDR A:(&baseOffset+0x2431014)
y.create.l HWIO_PMIC_ARB2_CHNL6_WDATA1_ADDR A:(&baseOffset+0x2432014)
y.create.l HWIO_PMIC_ARB3_CHNL6_WDATA1_ADDR A:(&baseOffset+0x2433014)
y.create.l HWIO_PMIC_ARB0_CHNL7_WDATA1_ADDR A:(&baseOffset+0x2438014)
y.create.l HWIO_PMIC_ARB1_CHNL7_WDATA1_ADDR A:(&baseOffset+0x2439014)
y.create.l HWIO_PMIC_ARB2_CHNL7_WDATA1_ADDR A:(&baseOffset+0x243a014)
y.create.l HWIO_PMIC_ARB3_CHNL7_WDATA1_ADDR A:(&baseOffset+0x243b014)
y.create.l HWIO_PMIC_ARB0_CHNL8_WDATA1_ADDR A:(&baseOffset+0x2440014)
y.create.l HWIO_PMIC_ARB1_CHNL8_WDATA1_ADDR A:(&baseOffset+0x2441014)
y.create.l HWIO_PMIC_ARB2_CHNL8_WDATA1_ADDR A:(&baseOffset+0x2442014)
y.create.l HWIO_PMIC_ARB3_CHNL8_WDATA1_ADDR A:(&baseOffset+0x2443014)
y.create.l HWIO_PMIC_ARB0_CHNL9_WDATA1_ADDR A:(&baseOffset+0x2448014)
y.create.l HWIO_PMIC_ARB1_CHNL9_WDATA1_ADDR A:(&baseOffset+0x2449014)
y.create.l HWIO_PMIC_ARB2_CHNL9_WDATA1_ADDR A:(&baseOffset+0x244a014)
y.create.l HWIO_PMIC_ARB3_CHNL9_WDATA1_ADDR A:(&baseOffset+0x244b014)
y.create.l HWIO_PMIC_ARB0_CHNL0_RDATA0_ADDR A:(&baseOffset+0x2400018)
y.create.l HWIO_PMIC_ARB1_CHNL0_RDATA0_ADDR A:(&baseOffset+0x2401018)
y.create.l HWIO_PMIC_ARB2_CHNL0_RDATA0_ADDR A:(&baseOffset+0x2402018)
y.create.l HWIO_PMIC_ARB3_CHNL0_RDATA0_ADDR A:(&baseOffset+0x2403018)
y.create.l HWIO_PMIC_ARB0_CHNL1_RDATA0_ADDR A:(&baseOffset+0x2408018)
y.create.l HWIO_PMIC_ARB1_CHNL1_RDATA0_ADDR A:(&baseOffset+0x2409018)
y.create.l HWIO_PMIC_ARB2_CHNL1_RDATA0_ADDR A:(&baseOffset+0x240a018)
y.create.l HWIO_PMIC_ARB3_CHNL1_RDATA0_ADDR A:(&baseOffset+0x240b018)
y.create.l HWIO_PMIC_ARB0_CHNL2_RDATA0_ADDR A:(&baseOffset+0x2410018)
y.create.l HWIO_PMIC_ARB1_CHNL2_RDATA0_ADDR A:(&baseOffset+0x2411018)
y.create.l HWIO_PMIC_ARB2_CHNL2_RDATA0_ADDR A:(&baseOffset+0x2412018)
y.create.l HWIO_PMIC_ARB3_CHNL2_RDATA0_ADDR A:(&baseOffset+0x2413018)
y.create.l HWIO_PMIC_ARB0_CHNL3_RDATA0_ADDR A:(&baseOffset+0x2418018)
y.create.l HWIO_PMIC_ARB1_CHNL3_RDATA0_ADDR A:(&baseOffset+0x2419018)
y.create.l HWIO_PMIC_ARB2_CHNL3_RDATA0_ADDR A:(&baseOffset+0x241a018)
y.create.l HWIO_PMIC_ARB3_CHNL3_RDATA0_ADDR A:(&baseOffset+0x241b018)
y.create.l HWIO_PMIC_ARB0_CHNL4_RDATA0_ADDR A:(&baseOffset+0x2420018)
y.create.l HWIO_PMIC_ARB1_CHNL4_RDATA0_ADDR A:(&baseOffset+0x2421018)
y.create.l HWIO_PMIC_ARB2_CHNL4_RDATA0_ADDR A:(&baseOffset+0x2422018)
y.create.l HWIO_PMIC_ARB3_CHNL4_RDATA0_ADDR A:(&baseOffset+0x2423018)
y.create.l HWIO_PMIC_ARB0_CHNL5_RDATA0_ADDR A:(&baseOffset+0x2428018)
y.create.l HWIO_PMIC_ARB1_CHNL5_RDATA0_ADDR A:(&baseOffset+0x2429018)
y.create.l HWIO_PMIC_ARB2_CHNL5_RDATA0_ADDR A:(&baseOffset+0x242a018)
y.create.l HWIO_PMIC_ARB3_CHNL5_RDATA0_ADDR A:(&baseOffset+0x242b018)
y.create.l HWIO_PMIC_ARB0_CHNL6_RDATA0_ADDR A:(&baseOffset+0x2430018)
y.create.l HWIO_PMIC_ARB1_CHNL6_RDATA0_ADDR A:(&baseOffset+0x2431018)
y.create.l HWIO_PMIC_ARB2_CHNL6_RDATA0_ADDR A:(&baseOffset+0x2432018)
y.create.l HWIO_PMIC_ARB3_CHNL6_RDATA0_ADDR A:(&baseOffset+0x2433018)
y.create.l HWIO_PMIC_ARB0_CHNL7_RDATA0_ADDR A:(&baseOffset+0x2438018)
y.create.l HWIO_PMIC_ARB1_CHNL7_RDATA0_ADDR A:(&baseOffset+0x2439018)
y.create.l HWIO_PMIC_ARB2_CHNL7_RDATA0_ADDR A:(&baseOffset+0x243a018)
y.create.l HWIO_PMIC_ARB3_CHNL7_RDATA0_ADDR A:(&baseOffset+0x243b018)
y.create.l HWIO_PMIC_ARB0_CHNL8_RDATA0_ADDR A:(&baseOffset+0x2440018)
y.create.l HWIO_PMIC_ARB1_CHNL8_RDATA0_ADDR A:(&baseOffset+0x2441018)
y.create.l HWIO_PMIC_ARB2_CHNL8_RDATA0_ADDR A:(&baseOffset+0x2442018)
y.create.l HWIO_PMIC_ARB3_CHNL8_RDATA0_ADDR A:(&baseOffset+0x2443018)
y.create.l HWIO_PMIC_ARB0_CHNL9_RDATA0_ADDR A:(&baseOffset+0x2448018)
y.create.l HWIO_PMIC_ARB1_CHNL9_RDATA0_ADDR A:(&baseOffset+0x2449018)
y.create.l HWIO_PMIC_ARB2_CHNL9_RDATA0_ADDR A:(&baseOffset+0x244a018)
y.create.l HWIO_PMIC_ARB3_CHNL9_RDATA0_ADDR A:(&baseOffset+0x244b018)
y.create.l HWIO_PMIC_ARB0_CHNL0_RDATA1_ADDR A:(&baseOffset+0x240001c)
y.create.l HWIO_PMIC_ARB1_CHNL0_RDATA1_ADDR A:(&baseOffset+0x240101c)
y.create.l HWIO_PMIC_ARB2_CHNL0_RDATA1_ADDR A:(&baseOffset+0x240201c)
y.create.l HWIO_PMIC_ARB3_CHNL0_RDATA1_ADDR A:(&baseOffset+0x240301c)
y.create.l HWIO_PMIC_ARB0_CHNL1_RDATA1_ADDR A:(&baseOffset+0x240801c)
y.create.l HWIO_PMIC_ARB1_CHNL1_RDATA1_ADDR A:(&baseOffset+0x240901c)
y.create.l HWIO_PMIC_ARB2_CHNL1_RDATA1_ADDR A:(&baseOffset+0x240a01c)
y.create.l HWIO_PMIC_ARB3_CHNL1_RDATA1_ADDR A:(&baseOffset+0x240b01c)
y.create.l HWIO_PMIC_ARB0_CHNL2_RDATA1_ADDR A:(&baseOffset+0x241001c)
y.create.l HWIO_PMIC_ARB1_CHNL2_RDATA1_ADDR A:(&baseOffset+0x241101c)
y.create.l HWIO_PMIC_ARB2_CHNL2_RDATA1_ADDR A:(&baseOffset+0x241201c)
y.create.l HWIO_PMIC_ARB3_CHNL2_RDATA1_ADDR A:(&baseOffset+0x241301c)
y.create.l HWIO_PMIC_ARB0_CHNL3_RDATA1_ADDR A:(&baseOffset+0x241801c)
y.create.l HWIO_PMIC_ARB1_CHNL3_RDATA1_ADDR A:(&baseOffset+0x241901c)
y.create.l HWIO_PMIC_ARB2_CHNL3_RDATA1_ADDR A:(&baseOffset+0x241a01c)
y.create.l HWIO_PMIC_ARB3_CHNL3_RDATA1_ADDR A:(&baseOffset+0x241b01c)
y.create.l HWIO_PMIC_ARB0_CHNL4_RDATA1_ADDR A:(&baseOffset+0x242001c)
y.create.l HWIO_PMIC_ARB1_CHNL4_RDATA1_ADDR A:(&baseOffset+0x242101c)
y.create.l HWIO_PMIC_ARB2_CHNL4_RDATA1_ADDR A:(&baseOffset+0x242201c)
y.create.l HWIO_PMIC_ARB3_CHNL4_RDATA1_ADDR A:(&baseOffset+0x242301c)
y.create.l HWIO_PMIC_ARB0_CHNL5_RDATA1_ADDR A:(&baseOffset+0x242801c)
y.create.l HWIO_PMIC_ARB1_CHNL5_RDATA1_ADDR A:(&baseOffset+0x242901c)
y.create.l HWIO_PMIC_ARB2_CHNL5_RDATA1_ADDR A:(&baseOffset+0x242a01c)
y.create.l HWIO_PMIC_ARB3_CHNL5_RDATA1_ADDR A:(&baseOffset+0x242b01c)
y.create.l HWIO_PMIC_ARB0_CHNL6_RDATA1_ADDR A:(&baseOffset+0x243001c)
y.create.l HWIO_PMIC_ARB1_CHNL6_RDATA1_ADDR A:(&baseOffset+0x243101c)
y.create.l HWIO_PMIC_ARB2_CHNL6_RDATA1_ADDR A:(&baseOffset+0x243201c)
y.create.l HWIO_PMIC_ARB3_CHNL6_RDATA1_ADDR A:(&baseOffset+0x243301c)
y.create.l HWIO_PMIC_ARB0_CHNL7_RDATA1_ADDR A:(&baseOffset+0x243801c)
y.create.l HWIO_PMIC_ARB1_CHNL7_RDATA1_ADDR A:(&baseOffset+0x243901c)
y.create.l HWIO_PMIC_ARB2_CHNL7_RDATA1_ADDR A:(&baseOffset+0x243a01c)
y.create.l HWIO_PMIC_ARB3_CHNL7_RDATA1_ADDR A:(&baseOffset+0x243b01c)
y.create.l HWIO_PMIC_ARB0_CHNL8_RDATA1_ADDR A:(&baseOffset+0x244001c)
y.create.l HWIO_PMIC_ARB1_CHNL8_RDATA1_ADDR A:(&baseOffset+0x244101c)
y.create.l HWIO_PMIC_ARB2_CHNL8_RDATA1_ADDR A:(&baseOffset+0x244201c)
y.create.l HWIO_PMIC_ARB3_CHNL8_RDATA1_ADDR A:(&baseOffset+0x244301c)
y.create.l HWIO_PMIC_ARB0_CHNL9_RDATA1_ADDR A:(&baseOffset+0x244801c)
y.create.l HWIO_PMIC_ARB1_CHNL9_RDATA1_ADDR A:(&baseOffset+0x244901c)
y.create.l HWIO_PMIC_ARB2_CHNL9_RDATA1_ADDR A:(&baseOffset+0x244a01c)
y.create.l HWIO_PMIC_ARB3_CHNL9_RDATA1_ADDR A:(&baseOffset+0x244b01c)
y.create.l HWIO_PMIC_ARB0_CHNL0_RDATA2_ADDR A:(&baseOffset+0x2400020)
y.create.l HWIO_PMIC_ARB1_CHNL0_RDATA2_ADDR A:(&baseOffset+0x2401020)
y.create.l HWIO_PMIC_ARB2_CHNL0_RDATA2_ADDR A:(&baseOffset+0x2402020)
y.create.l HWIO_PMIC_ARB3_CHNL0_RDATA2_ADDR A:(&baseOffset+0x2403020)
y.create.l HWIO_PMIC_ARB0_CHNL1_RDATA2_ADDR A:(&baseOffset+0x2408020)
y.create.l HWIO_PMIC_ARB1_CHNL1_RDATA2_ADDR A:(&baseOffset+0x2409020)
y.create.l HWIO_PMIC_ARB2_CHNL1_RDATA2_ADDR A:(&baseOffset+0x240a020)
y.create.l HWIO_PMIC_ARB3_CHNL1_RDATA2_ADDR A:(&baseOffset+0x240b020)
y.create.l HWIO_PMIC_ARB0_CHNL2_RDATA2_ADDR A:(&baseOffset+0x2410020)
y.create.l HWIO_PMIC_ARB1_CHNL2_RDATA2_ADDR A:(&baseOffset+0x2411020)
y.create.l HWIO_PMIC_ARB2_CHNL2_RDATA2_ADDR A:(&baseOffset+0x2412020)
y.create.l HWIO_PMIC_ARB3_CHNL2_RDATA2_ADDR A:(&baseOffset+0x2413020)
y.create.l HWIO_PMIC_ARB0_CHNL3_RDATA2_ADDR A:(&baseOffset+0x2418020)
y.create.l HWIO_PMIC_ARB1_CHNL3_RDATA2_ADDR A:(&baseOffset+0x2419020)
y.create.l HWIO_PMIC_ARB2_CHNL3_RDATA2_ADDR A:(&baseOffset+0x241a020)
y.create.l HWIO_PMIC_ARB3_CHNL3_RDATA2_ADDR A:(&baseOffset+0x241b020)
y.create.l HWIO_PMIC_ARB0_CHNL4_RDATA2_ADDR A:(&baseOffset+0x2420020)
y.create.l HWIO_PMIC_ARB1_CHNL4_RDATA2_ADDR A:(&baseOffset+0x2421020)
y.create.l HWIO_PMIC_ARB2_CHNL4_RDATA2_ADDR A:(&baseOffset+0x2422020)
y.create.l HWIO_PMIC_ARB3_CHNL4_RDATA2_ADDR A:(&baseOffset+0x2423020)
y.create.l HWIO_PMIC_ARB0_CHNL5_RDATA2_ADDR A:(&baseOffset+0x2428020)
y.create.l HWIO_PMIC_ARB1_CHNL5_RDATA2_ADDR A:(&baseOffset+0x2429020)
y.create.l HWIO_PMIC_ARB2_CHNL5_RDATA2_ADDR A:(&baseOffset+0x242a020)
y.create.l HWIO_PMIC_ARB3_CHNL5_RDATA2_ADDR A:(&baseOffset+0x242b020)
y.create.l HWIO_PMIC_ARB0_CHNL6_RDATA2_ADDR A:(&baseOffset+0x2430020)
y.create.l HWIO_PMIC_ARB1_CHNL6_RDATA2_ADDR A:(&baseOffset+0x2431020)
y.create.l HWIO_PMIC_ARB2_CHNL6_RDATA2_ADDR A:(&baseOffset+0x2432020)
y.create.l HWIO_PMIC_ARB3_CHNL6_RDATA2_ADDR A:(&baseOffset+0x2433020)
y.create.l HWIO_PMIC_ARB0_CHNL7_RDATA2_ADDR A:(&baseOffset+0x2438020)
y.create.l HWIO_PMIC_ARB1_CHNL7_RDATA2_ADDR A:(&baseOffset+0x2439020)
y.create.l HWIO_PMIC_ARB2_CHNL7_RDATA2_ADDR A:(&baseOffset+0x243a020)
y.create.l HWIO_PMIC_ARB3_CHNL7_RDATA2_ADDR A:(&baseOffset+0x243b020)
y.create.l HWIO_PMIC_ARB0_CHNL8_RDATA2_ADDR A:(&baseOffset+0x2440020)
y.create.l HWIO_PMIC_ARB1_CHNL8_RDATA2_ADDR A:(&baseOffset+0x2441020)
y.create.l HWIO_PMIC_ARB2_CHNL8_RDATA2_ADDR A:(&baseOffset+0x2442020)
y.create.l HWIO_PMIC_ARB3_CHNL8_RDATA2_ADDR A:(&baseOffset+0x2443020)
y.create.l HWIO_PMIC_ARB0_CHNL9_RDATA2_ADDR A:(&baseOffset+0x2448020)
y.create.l HWIO_PMIC_ARB1_CHNL9_RDATA2_ADDR A:(&baseOffset+0x2449020)
y.create.l HWIO_PMIC_ARB2_CHNL9_RDATA2_ADDR A:(&baseOffset+0x244a020)
y.create.l HWIO_PMIC_ARB3_CHNL9_RDATA2_ADDR A:(&baseOffset+0x244b020)
y.create.l HWIO_PMIC_ARB_OBS0_CHNL0_CMD_ADDR A:(&baseOffset+0x2c00000)
y.create.l HWIO_PMIC_ARB_OBS1_CHNL0_CMD_ADDR A:(&baseOffset+0x2c01000)
y.create.l HWIO_PMIC_ARB_OBS2_CHNL0_CMD_ADDR A:(&baseOffset+0x2c02000)
y.create.l HWIO_PMIC_ARB_OBS3_CHNL0_CMD_ADDR A:(&baseOffset+0x2c03000)
y.create.l HWIO_PMIC_ARB_OBS0_CHNL1_CMD_ADDR A:(&baseOffset+0x2c08000)
y.create.l HWIO_PMIC_ARB_OBS1_CHNL1_CMD_ADDR A:(&baseOffset+0x2c09000)
y.create.l HWIO_PMIC_ARB_OBS2_CHNL1_CMD_ADDR A:(&baseOffset+0x2c0a000)
y.create.l HWIO_PMIC_ARB_OBS3_CHNL1_CMD_ADDR A:(&baseOffset+0x2c0b000)
y.create.l HWIO_PMIC_ARB_OBS0_CHNL2_CMD_ADDR A:(&baseOffset+0x2c10000)
y.create.l HWIO_PMIC_ARB_OBS1_CHNL2_CMD_ADDR A:(&baseOffset+0x2c11000)
y.create.l HWIO_PMIC_ARB_OBS2_CHNL2_CMD_ADDR A:(&baseOffset+0x2c12000)
y.create.l HWIO_PMIC_ARB_OBS3_CHNL2_CMD_ADDR A:(&baseOffset+0x2c13000)
y.create.l HWIO_PMIC_ARB_OBS0_CHNL3_CMD_ADDR A:(&baseOffset+0x2c18000)
y.create.l HWIO_PMIC_ARB_OBS1_CHNL3_CMD_ADDR A:(&baseOffset+0x2c19000)
y.create.l HWIO_PMIC_ARB_OBS2_CHNL3_CMD_ADDR A:(&baseOffset+0x2c1a000)
y.create.l HWIO_PMIC_ARB_OBS3_CHNL3_CMD_ADDR A:(&baseOffset+0x2c1b000)
y.create.l HWIO_PMIC_ARB_OBS0_CHNL4_CMD_ADDR A:(&baseOffset+0x2c20000)
y.create.l HWIO_PMIC_ARB_OBS1_CHNL4_CMD_ADDR A:(&baseOffset+0x2c21000)
y.create.l HWIO_PMIC_ARB_OBS2_CHNL4_CMD_ADDR A:(&baseOffset+0x2c22000)
y.create.l HWIO_PMIC_ARB_OBS3_CHNL4_CMD_ADDR A:(&baseOffset+0x2c23000)
y.create.l HWIO_PMIC_ARB_OBS0_CHNL5_CMD_ADDR A:(&baseOffset+0x2c28000)
y.create.l HWIO_PMIC_ARB_OBS1_CHNL5_CMD_ADDR A:(&baseOffset+0x2c29000)
y.create.l HWIO_PMIC_ARB_OBS2_CHNL5_CMD_ADDR A:(&baseOffset+0x2c2a000)
y.create.l HWIO_PMIC_ARB_OBS3_CHNL5_CMD_ADDR A:(&baseOffset+0x2c2b000)
y.create.l HWIO_PMIC_ARB_OBS0_CHNL6_CMD_ADDR A:(&baseOffset+0x2c30000)
y.create.l HWIO_PMIC_ARB_OBS1_CHNL6_CMD_ADDR A:(&baseOffset+0x2c31000)
y.create.l HWIO_PMIC_ARB_OBS2_CHNL6_CMD_ADDR A:(&baseOffset+0x2c32000)
y.create.l HWIO_PMIC_ARB_OBS3_CHNL6_CMD_ADDR A:(&baseOffset+0x2c33000)
y.create.l HWIO_PMIC_ARB_OBS0_CHNL7_CMD_ADDR A:(&baseOffset+0x2c38000)
y.create.l HWIO_PMIC_ARB_OBS1_CHNL7_CMD_ADDR A:(&baseOffset+0x2c39000)
y.create.l HWIO_PMIC_ARB_OBS2_CHNL7_CMD_ADDR A:(&baseOffset+0x2c3a000)
y.create.l HWIO_PMIC_ARB_OBS3_CHNL7_CMD_ADDR A:(&baseOffset+0x2c3b000)
y.create.l HWIO_PMIC_ARB_OBS0_CHNL8_CMD_ADDR A:(&baseOffset+0x2c40000)
y.create.l HWIO_PMIC_ARB_OBS1_CHNL8_CMD_ADDR A:(&baseOffset+0x2c41000)
y.create.l HWIO_PMIC_ARB_OBS2_CHNL8_CMD_ADDR A:(&baseOffset+0x2c42000)
y.create.l HWIO_PMIC_ARB_OBS3_CHNL8_CMD_ADDR A:(&baseOffset+0x2c43000)
y.create.l HWIO_PMIC_ARB_OBS0_CHNL9_CMD_ADDR A:(&baseOffset+0x2c48000)
y.create.l HWIO_PMIC_ARB_OBS1_CHNL9_CMD_ADDR A:(&baseOffset+0x2c49000)
y.create.l HWIO_PMIC_ARB_OBS2_CHNL9_CMD_ADDR A:(&baseOffset+0x2c4a000)
y.create.l HWIO_PMIC_ARB_OBS3_CHNL9_CMD_ADDR A:(&baseOffset+0x2c4b000)
y.create.l HWIO_PMIC_ARB_OBS0_CHNL0_CONFIG_ADDR A:(&baseOffset+0x2c00004)
y.create.l HWIO_PMIC_ARB_OBS1_CHNL0_CONFIG_ADDR A:(&baseOffset+0x2c01004)
y.create.l HWIO_PMIC_ARB_OBS2_CHNL0_CONFIG_ADDR A:(&baseOffset+0x2c02004)
y.create.l HWIO_PMIC_ARB_OBS3_CHNL0_CONFIG_ADDR A:(&baseOffset+0x2c03004)
y.create.l HWIO_PMIC_ARB_OBS0_CHNL1_CONFIG_ADDR A:(&baseOffset+0x2c08004)
y.create.l HWIO_PMIC_ARB_OBS1_CHNL1_CONFIG_ADDR A:(&baseOffset+0x2c09004)
y.create.l HWIO_PMIC_ARB_OBS2_CHNL1_CONFIG_ADDR A:(&baseOffset+0x2c0a004)
y.create.l HWIO_PMIC_ARB_OBS3_CHNL1_CONFIG_ADDR A:(&baseOffset+0x2c0b004)
y.create.l HWIO_PMIC_ARB_OBS0_CHNL2_CONFIG_ADDR A:(&baseOffset+0x2c10004)
y.create.l HWIO_PMIC_ARB_OBS1_CHNL2_CONFIG_ADDR A:(&baseOffset+0x2c11004)
y.create.l HWIO_PMIC_ARB_OBS2_CHNL2_CONFIG_ADDR A:(&baseOffset+0x2c12004)
y.create.l HWIO_PMIC_ARB_OBS3_CHNL2_CONFIG_ADDR A:(&baseOffset+0x2c13004)
y.create.l HWIO_PMIC_ARB_OBS0_CHNL3_CONFIG_ADDR A:(&baseOffset+0x2c18004)
y.create.l HWIO_PMIC_ARB_OBS1_CHNL3_CONFIG_ADDR A:(&baseOffset+0x2c19004)
y.create.l HWIO_PMIC_ARB_OBS2_CHNL3_CONFIG_ADDR A:(&baseOffset+0x2c1a004)
y.create.l HWIO_PMIC_ARB_OBS3_CHNL3_CONFIG_ADDR A:(&baseOffset+0x2c1b004)
y.create.l HWIO_PMIC_ARB_OBS0_CHNL4_CONFIG_ADDR A:(&baseOffset+0x2c20004)
y.create.l HWIO_PMIC_ARB_OBS1_CHNL4_CONFIG_ADDR A:(&baseOffset+0x2c21004)
y.create.l HWIO_PMIC_ARB_OBS2_CHNL4_CONFIG_ADDR A:(&baseOffset+0x2c22004)
y.create.l HWIO_PMIC_ARB_OBS3_CHNL4_CONFIG_ADDR A:(&baseOffset+0x2c23004)
y.create.l HWIO_PMIC_ARB_OBS0_CHNL5_CONFIG_ADDR A:(&baseOffset+0x2c28004)
y.create.l HWIO_PMIC_ARB_OBS1_CHNL5_CONFIG_ADDR A:(&baseOffset+0x2c29004)
y.create.l HWIO_PMIC_ARB_OBS2_CHNL5_CONFIG_ADDR A:(&baseOffset+0x2c2a004)
y.create.l HWIO_PMIC_ARB_OBS3_CHNL5_CONFIG_ADDR A:(&baseOffset+0x2c2b004)
y.create.l HWIO_PMIC_ARB_OBS0_CHNL6_CONFIG_ADDR A:(&baseOffset+0x2c30004)
y.create.l HWIO_PMIC_ARB_OBS1_CHNL6_CONFIG_ADDR A:(&baseOffset+0x2c31004)
y.create.l HWIO_PMIC_ARB_OBS2_CHNL6_CONFIG_ADDR A:(&baseOffset+0x2c32004)
y.create.l HWIO_PMIC_ARB_OBS3_CHNL6_CONFIG_ADDR A:(&baseOffset+0x2c33004)
y.create.l HWIO_PMIC_ARB_OBS0_CHNL7_CONFIG_ADDR A:(&baseOffset+0x2c38004)
y.create.l HWIO_PMIC_ARB_OBS1_CHNL7_CONFIG_ADDR A:(&baseOffset+0x2c39004)
y.create.l HWIO_PMIC_ARB_OBS2_CHNL7_CONFIG_ADDR A:(&baseOffset+0x2c3a004)
y.create.l HWIO_PMIC_ARB_OBS3_CHNL7_CONFIG_ADDR A:(&baseOffset+0x2c3b004)
y.create.l HWIO_PMIC_ARB_OBS0_CHNL8_CONFIG_ADDR A:(&baseOffset+0x2c40004)
y.create.l HWIO_PMIC_ARB_OBS1_CHNL8_CONFIG_ADDR A:(&baseOffset+0x2c41004)
y.create.l HWIO_PMIC_ARB_OBS2_CHNL8_CONFIG_ADDR A:(&baseOffset+0x2c42004)
y.create.l HWIO_PMIC_ARB_OBS3_CHNL8_CONFIG_ADDR A:(&baseOffset+0x2c43004)
y.create.l HWIO_PMIC_ARB_OBS0_CHNL9_CONFIG_ADDR A:(&baseOffset+0x2c48004)
y.create.l HWIO_PMIC_ARB_OBS1_CHNL9_CONFIG_ADDR A:(&baseOffset+0x2c49004)
y.create.l HWIO_PMIC_ARB_OBS2_CHNL9_CONFIG_ADDR A:(&baseOffset+0x2c4a004)
y.create.l HWIO_PMIC_ARB_OBS3_CHNL9_CONFIG_ADDR A:(&baseOffset+0x2c4b004)
y.create.l HWIO_PMIC_ARB_OBS0_CHNL0_STATUS_ADDR A:(&baseOffset+0x2c00008)
y.create.l HWIO_PMIC_ARB_OBS1_CHNL0_STATUS_ADDR A:(&baseOffset+0x2c01008)
y.create.l HWIO_PMIC_ARB_OBS2_CHNL0_STATUS_ADDR A:(&baseOffset+0x2c02008)
y.create.l HWIO_PMIC_ARB_OBS3_CHNL0_STATUS_ADDR A:(&baseOffset+0x2c03008)
y.create.l HWIO_PMIC_ARB_OBS0_CHNL1_STATUS_ADDR A:(&baseOffset+0x2c08008)
y.create.l HWIO_PMIC_ARB_OBS1_CHNL1_STATUS_ADDR A:(&baseOffset+0x2c09008)
y.create.l HWIO_PMIC_ARB_OBS2_CHNL1_STATUS_ADDR A:(&baseOffset+0x2c0a008)
y.create.l HWIO_PMIC_ARB_OBS3_CHNL1_STATUS_ADDR A:(&baseOffset+0x2c0b008)
y.create.l HWIO_PMIC_ARB_OBS0_CHNL2_STATUS_ADDR A:(&baseOffset+0x2c10008)
y.create.l HWIO_PMIC_ARB_OBS1_CHNL2_STATUS_ADDR A:(&baseOffset+0x2c11008)
y.create.l HWIO_PMIC_ARB_OBS2_CHNL2_STATUS_ADDR A:(&baseOffset+0x2c12008)
y.create.l HWIO_PMIC_ARB_OBS3_CHNL2_STATUS_ADDR A:(&baseOffset+0x2c13008)
y.create.l HWIO_PMIC_ARB_OBS0_CHNL3_STATUS_ADDR A:(&baseOffset+0x2c18008)
y.create.l HWIO_PMIC_ARB_OBS1_CHNL3_STATUS_ADDR A:(&baseOffset+0x2c19008)
y.create.l HWIO_PMIC_ARB_OBS2_CHNL3_STATUS_ADDR A:(&baseOffset+0x2c1a008)
y.create.l HWIO_PMIC_ARB_OBS3_CHNL3_STATUS_ADDR A:(&baseOffset+0x2c1b008)
y.create.l HWIO_PMIC_ARB_OBS0_CHNL4_STATUS_ADDR A:(&baseOffset+0x2c20008)
y.create.l HWIO_PMIC_ARB_OBS1_CHNL4_STATUS_ADDR A:(&baseOffset+0x2c21008)
y.create.l HWIO_PMIC_ARB_OBS2_CHNL4_STATUS_ADDR A:(&baseOffset+0x2c22008)
y.create.l HWIO_PMIC_ARB_OBS3_CHNL4_STATUS_ADDR A:(&baseOffset+0x2c23008)
y.create.l HWIO_PMIC_ARB_OBS0_CHNL5_STATUS_ADDR A:(&baseOffset+0x2c28008)
y.create.l HWIO_PMIC_ARB_OBS1_CHNL5_STATUS_ADDR A:(&baseOffset+0x2c29008)
y.create.l HWIO_PMIC_ARB_OBS2_CHNL5_STATUS_ADDR A:(&baseOffset+0x2c2a008)
y.create.l HWIO_PMIC_ARB_OBS3_CHNL5_STATUS_ADDR A:(&baseOffset+0x2c2b008)
y.create.l HWIO_PMIC_ARB_OBS0_CHNL6_STATUS_ADDR A:(&baseOffset+0x2c30008)
y.create.l HWIO_PMIC_ARB_OBS1_CHNL6_STATUS_ADDR A:(&baseOffset+0x2c31008)
y.create.l HWIO_PMIC_ARB_OBS2_CHNL6_STATUS_ADDR A:(&baseOffset+0x2c32008)
y.create.l HWIO_PMIC_ARB_OBS3_CHNL6_STATUS_ADDR A:(&baseOffset+0x2c33008)
y.create.l HWIO_PMIC_ARB_OBS0_CHNL7_STATUS_ADDR A:(&baseOffset+0x2c38008)
y.create.l HWIO_PMIC_ARB_OBS1_CHNL7_STATUS_ADDR A:(&baseOffset+0x2c39008)
y.create.l HWIO_PMIC_ARB_OBS2_CHNL7_STATUS_ADDR A:(&baseOffset+0x2c3a008)
y.create.l HWIO_PMIC_ARB_OBS3_CHNL7_STATUS_ADDR A:(&baseOffset+0x2c3b008)
y.create.l HWIO_PMIC_ARB_OBS0_CHNL8_STATUS_ADDR A:(&baseOffset+0x2c40008)
y.create.l HWIO_PMIC_ARB_OBS1_CHNL8_STATUS_ADDR A:(&baseOffset+0x2c41008)
y.create.l HWIO_PMIC_ARB_OBS2_CHNL8_STATUS_ADDR A:(&baseOffset+0x2c42008)
y.create.l HWIO_PMIC_ARB_OBS3_CHNL8_STATUS_ADDR A:(&baseOffset+0x2c43008)
y.create.l HWIO_PMIC_ARB_OBS0_CHNL9_STATUS_ADDR A:(&baseOffset+0x2c48008)
y.create.l HWIO_PMIC_ARB_OBS1_CHNL9_STATUS_ADDR A:(&baseOffset+0x2c49008)
y.create.l HWIO_PMIC_ARB_OBS2_CHNL9_STATUS_ADDR A:(&baseOffset+0x2c4a008)
y.create.l HWIO_PMIC_ARB_OBS3_CHNL9_STATUS_ADDR A:(&baseOffset+0x2c4b008)
y.create.l HWIO_PMIC_ARB_OBS0_CHNL0_RDATA0_ADDR A:(&baseOffset+0x2c00018)
y.create.l HWIO_PMIC_ARB_OBS1_CHNL0_RDATA0_ADDR A:(&baseOffset+0x2c01018)
y.create.l HWIO_PMIC_ARB_OBS2_CHNL0_RDATA0_ADDR A:(&baseOffset+0x2c02018)
y.create.l HWIO_PMIC_ARB_OBS3_CHNL0_RDATA0_ADDR A:(&baseOffset+0x2c03018)
y.create.l HWIO_PMIC_ARB_OBS0_CHNL1_RDATA0_ADDR A:(&baseOffset+0x2c08018)
y.create.l HWIO_PMIC_ARB_OBS1_CHNL1_RDATA0_ADDR A:(&baseOffset+0x2c09018)
y.create.l HWIO_PMIC_ARB_OBS2_CHNL1_RDATA0_ADDR A:(&baseOffset+0x2c0a018)
y.create.l HWIO_PMIC_ARB_OBS3_CHNL1_RDATA0_ADDR A:(&baseOffset+0x2c0b018)
y.create.l HWIO_PMIC_ARB_OBS0_CHNL2_RDATA0_ADDR A:(&baseOffset+0x2c10018)
y.create.l HWIO_PMIC_ARB_OBS1_CHNL2_RDATA0_ADDR A:(&baseOffset+0x2c11018)
y.create.l HWIO_PMIC_ARB_OBS2_CHNL2_RDATA0_ADDR A:(&baseOffset+0x2c12018)
y.create.l HWIO_PMIC_ARB_OBS3_CHNL2_RDATA0_ADDR A:(&baseOffset+0x2c13018)
y.create.l HWIO_PMIC_ARB_OBS0_CHNL3_RDATA0_ADDR A:(&baseOffset+0x2c18018)
y.create.l HWIO_PMIC_ARB_OBS1_CHNL3_RDATA0_ADDR A:(&baseOffset+0x2c19018)
y.create.l HWIO_PMIC_ARB_OBS2_CHNL3_RDATA0_ADDR A:(&baseOffset+0x2c1a018)
y.create.l HWIO_PMIC_ARB_OBS3_CHNL3_RDATA0_ADDR A:(&baseOffset+0x2c1b018)
y.create.l HWIO_PMIC_ARB_OBS0_CHNL4_RDATA0_ADDR A:(&baseOffset+0x2c20018)
y.create.l HWIO_PMIC_ARB_OBS1_CHNL4_RDATA0_ADDR A:(&baseOffset+0x2c21018)
y.create.l HWIO_PMIC_ARB_OBS2_CHNL4_RDATA0_ADDR A:(&baseOffset+0x2c22018)
y.create.l HWIO_PMIC_ARB_OBS3_CHNL4_RDATA0_ADDR A:(&baseOffset+0x2c23018)
y.create.l HWIO_PMIC_ARB_OBS0_CHNL5_RDATA0_ADDR A:(&baseOffset+0x2c28018)
y.create.l HWIO_PMIC_ARB_OBS1_CHNL5_RDATA0_ADDR A:(&baseOffset+0x2c29018)
y.create.l HWIO_PMIC_ARB_OBS2_CHNL5_RDATA0_ADDR A:(&baseOffset+0x2c2a018)
y.create.l HWIO_PMIC_ARB_OBS3_CHNL5_RDATA0_ADDR A:(&baseOffset+0x2c2b018)
y.create.l HWIO_PMIC_ARB_OBS0_CHNL6_RDATA0_ADDR A:(&baseOffset+0x2c30018)
y.create.l HWIO_PMIC_ARB_OBS1_CHNL6_RDATA0_ADDR A:(&baseOffset+0x2c31018)
y.create.l HWIO_PMIC_ARB_OBS2_CHNL6_RDATA0_ADDR A:(&baseOffset+0x2c32018)
y.create.l HWIO_PMIC_ARB_OBS3_CHNL6_RDATA0_ADDR A:(&baseOffset+0x2c33018)
y.create.l HWIO_PMIC_ARB_OBS0_CHNL7_RDATA0_ADDR A:(&baseOffset+0x2c38018)
y.create.l HWIO_PMIC_ARB_OBS1_CHNL7_RDATA0_ADDR A:(&baseOffset+0x2c39018)
y.create.l HWIO_PMIC_ARB_OBS2_CHNL7_RDATA0_ADDR A:(&baseOffset+0x2c3a018)
y.create.l HWIO_PMIC_ARB_OBS3_CHNL7_RDATA0_ADDR A:(&baseOffset+0x2c3b018)
y.create.l HWIO_PMIC_ARB_OBS0_CHNL8_RDATA0_ADDR A:(&baseOffset+0x2c40018)
y.create.l HWIO_PMIC_ARB_OBS1_CHNL8_RDATA0_ADDR A:(&baseOffset+0x2c41018)
y.create.l HWIO_PMIC_ARB_OBS2_CHNL8_RDATA0_ADDR A:(&baseOffset+0x2c42018)
y.create.l HWIO_PMIC_ARB_OBS3_CHNL8_RDATA0_ADDR A:(&baseOffset+0x2c43018)
y.create.l HWIO_PMIC_ARB_OBS0_CHNL9_RDATA0_ADDR A:(&baseOffset+0x2c48018)
y.create.l HWIO_PMIC_ARB_OBS1_CHNL9_RDATA0_ADDR A:(&baseOffset+0x2c49018)
y.create.l HWIO_PMIC_ARB_OBS2_CHNL9_RDATA0_ADDR A:(&baseOffset+0x2c4a018)
y.create.l HWIO_PMIC_ARB_OBS3_CHNL9_RDATA0_ADDR A:(&baseOffset+0x2c4b018)
y.create.l HWIO_PMIC_ARB_OBS0_CHNL0_RDATA1_ADDR A:(&baseOffset+0x2c0001c)
y.create.l HWIO_PMIC_ARB_OBS1_CHNL0_RDATA1_ADDR A:(&baseOffset+0x2c0101c)
y.create.l HWIO_PMIC_ARB_OBS2_CHNL0_RDATA1_ADDR A:(&baseOffset+0x2c0201c)
y.create.l HWIO_PMIC_ARB_OBS3_CHNL0_RDATA1_ADDR A:(&baseOffset+0x2c0301c)
y.create.l HWIO_PMIC_ARB_OBS0_CHNL1_RDATA1_ADDR A:(&baseOffset+0x2c0801c)
y.create.l HWIO_PMIC_ARB_OBS1_CHNL1_RDATA1_ADDR A:(&baseOffset+0x2c0901c)
y.create.l HWIO_PMIC_ARB_OBS2_CHNL1_RDATA1_ADDR A:(&baseOffset+0x2c0a01c)
y.create.l HWIO_PMIC_ARB_OBS3_CHNL1_RDATA1_ADDR A:(&baseOffset+0x2c0b01c)
y.create.l HWIO_PMIC_ARB_OBS0_CHNL2_RDATA1_ADDR A:(&baseOffset+0x2c1001c)
y.create.l HWIO_PMIC_ARB_OBS1_CHNL2_RDATA1_ADDR A:(&baseOffset+0x2c1101c)
y.create.l HWIO_PMIC_ARB_OBS2_CHNL2_RDATA1_ADDR A:(&baseOffset+0x2c1201c)
y.create.l HWIO_PMIC_ARB_OBS3_CHNL2_RDATA1_ADDR A:(&baseOffset+0x2c1301c)
y.create.l HWIO_PMIC_ARB_OBS0_CHNL3_RDATA1_ADDR A:(&baseOffset+0x2c1801c)
y.create.l HWIO_PMIC_ARB_OBS1_CHNL3_RDATA1_ADDR A:(&baseOffset+0x2c1901c)
y.create.l HWIO_PMIC_ARB_OBS2_CHNL3_RDATA1_ADDR A:(&baseOffset+0x2c1a01c)
y.create.l HWIO_PMIC_ARB_OBS3_CHNL3_RDATA1_ADDR A:(&baseOffset+0x2c1b01c)
y.create.l HWIO_PMIC_ARB_OBS0_CHNL4_RDATA1_ADDR A:(&baseOffset+0x2c2001c)
y.create.l HWIO_PMIC_ARB_OBS1_CHNL4_RDATA1_ADDR A:(&baseOffset+0x2c2101c)
y.create.l HWIO_PMIC_ARB_OBS2_CHNL4_RDATA1_ADDR A:(&baseOffset+0x2c2201c)
y.create.l HWIO_PMIC_ARB_OBS3_CHNL4_RDATA1_ADDR A:(&baseOffset+0x2c2301c)
y.create.l HWIO_PMIC_ARB_OBS0_CHNL5_RDATA1_ADDR A:(&baseOffset+0x2c2801c)
y.create.l HWIO_PMIC_ARB_OBS1_CHNL5_RDATA1_ADDR A:(&baseOffset+0x2c2901c)
y.create.l HWIO_PMIC_ARB_OBS2_CHNL5_RDATA1_ADDR A:(&baseOffset+0x2c2a01c)
y.create.l HWIO_PMIC_ARB_OBS3_CHNL5_RDATA1_ADDR A:(&baseOffset+0x2c2b01c)
y.create.l HWIO_PMIC_ARB_OBS0_CHNL6_RDATA1_ADDR A:(&baseOffset+0x2c3001c)
y.create.l HWIO_PMIC_ARB_OBS1_CHNL6_RDATA1_ADDR A:(&baseOffset+0x2c3101c)
y.create.l HWIO_PMIC_ARB_OBS2_CHNL6_RDATA1_ADDR A:(&baseOffset+0x2c3201c)
y.create.l HWIO_PMIC_ARB_OBS3_CHNL6_RDATA1_ADDR A:(&baseOffset+0x2c3301c)
y.create.l HWIO_PMIC_ARB_OBS0_CHNL7_RDATA1_ADDR A:(&baseOffset+0x2c3801c)
y.create.l HWIO_PMIC_ARB_OBS1_CHNL7_RDATA1_ADDR A:(&baseOffset+0x2c3901c)
y.create.l HWIO_PMIC_ARB_OBS2_CHNL7_RDATA1_ADDR A:(&baseOffset+0x2c3a01c)
y.create.l HWIO_PMIC_ARB_OBS3_CHNL7_RDATA1_ADDR A:(&baseOffset+0x2c3b01c)
y.create.l HWIO_PMIC_ARB_OBS0_CHNL8_RDATA1_ADDR A:(&baseOffset+0x2c4001c)
y.create.l HWIO_PMIC_ARB_OBS1_CHNL8_RDATA1_ADDR A:(&baseOffset+0x2c4101c)
y.create.l HWIO_PMIC_ARB_OBS2_CHNL8_RDATA1_ADDR A:(&baseOffset+0x2c4201c)
y.create.l HWIO_PMIC_ARB_OBS3_CHNL8_RDATA1_ADDR A:(&baseOffset+0x2c4301c)
y.create.l HWIO_PMIC_ARB_OBS0_CHNL9_RDATA1_ADDR A:(&baseOffset+0x2c4801c)
y.create.l HWIO_PMIC_ARB_OBS1_CHNL9_RDATA1_ADDR A:(&baseOffset+0x2c4901c)
y.create.l HWIO_PMIC_ARB_OBS2_CHNL9_RDATA1_ADDR A:(&baseOffset+0x2c4a01c)
y.create.l HWIO_PMIC_ARB_OBS3_CHNL9_RDATA1_ADDR A:(&baseOffset+0x2c4b01c)
y.create.done
ENDDO