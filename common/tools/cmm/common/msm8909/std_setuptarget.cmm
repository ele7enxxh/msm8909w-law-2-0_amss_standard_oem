//============================================================================
//  Name:                                                                     
//    std_setuptarget.cmm 
//
//  Description:                                                              
//    Target specific script to setup the target to load a build
//                                                                            
// Copyright (c) 2012 - 2014 by Qualcomm Technologies, Incorporated.  All Rights Reserved.        
//
//
//
//
//                      EDIT HISTORY FOR FILE
//  This section contains comments describing changes made to the module.
//  Notice that changes are listed in reverse chronological order.
//
// when       who     		what, where, why
// --------   ---     		---------------------------------------------------------
// 03/01/2013 AJCheriyan	Changed breakpoint address to pbl_flash_detect
// 02/26/2013 AJCheriyan	Modified for MSM8x26
// 08/08/2012 AJCheriyan    Created for B-family 
//

MAIN:
	// Get to APPS PBL entry point
	;do std_debug_boot appspbl lpm_disable 0xFC016554
	
	

EXIT:
	ENDDO



