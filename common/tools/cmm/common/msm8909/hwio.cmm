Y.CREATE.L HWIO_MSS_QDSP6SS_DBG_CFG_DBG_SW_REG_BMSK 0xff000000
Y.CREATE.L HWIO_MSS_QDSP6SS_DBG_CFG_DBG_SW_REG_SHFT 0x18
Y.CREATE.L HWIO_GCC_MSS_CFG_AHB_CBCR_CLK_ENABLE_BMSK 0x1
Y.CREATE.L HWIO_MSS_QDSP6SS_CGC_OVERRIDE_CORE_RCLK_EN_BMSK 0x2
Y.CREATE.L HWIO_MSS_QDSP6SS_CGC_OVERRIDE_CORE_CLK_EN_BMSK 0x1
Y.CREATE.L HWIO_WCSS_A_PMU_CCPU_BOOT_REMAP_ADDR_CCPU_BOOT_REMAP_ADDR_BMSK 0xffff
Y.CREATE.L HWIO_GCC_MSS_CFG_AHB_CBCR_CLK_ENABLE_SHFT 0x0
Y.CREATE.L HWIO_MSS_QDSP6SS_CGC_OVERRIDE_CORE_RCLK_EN_SHFT 0x1
Y.CREATE.L HWIO_MSS_QDSP6SS_CGC_OVERRIDE_CORE_CLK_EN_SHFT 0x0
Y.CREATE.L HWIO_WCSS_A_PMU_CCPU_BOOT_REMAP_ADDR_CCPU_BOOT_REMAP_ADDR_SHFT 0x0
y.create.l HWIO_APCS_QTMR_AC_CNTFRQ_ADDR A:0xb020000
y.create.l HWIO_APCS_QTMR_AC_CNTSR_ADDR A:0xb020004
y.create.l HWIO_APCS_QTMR_AC_CNTTID_ADDR A:0xb020008
y.create.l HWIO_APCS_QTMR_AC_CNTACR_0_ADDR A:0xb020040
y.create.l HWIO_APCS_QTMR_AC_CNTACR_1_ADDR A:0xb020044
y.create.l HWIO_APCS_QTMR_AC_CNTACR_2_ADDR A:0xb020048
y.create.l HWIO_APCS_QTMR_AC_CNTACR_3_ADDR A:0xb02004c
y.create.l HWIO_APCS_QTMR_AC_CNTACR_4_ADDR A:0xb020050
y.create.l HWIO_APCS_QTMR_AC_CNTACR_5_ADDR A:0xb020054
y.create.l HWIO_APCS_QTMR_AC_CNTACR_6_ADDR A:0xb020058
y.create.l HWIO_APCS_QTMR_AC_CNTVOFF_LO_0_ADDR A:0xb020080
y.create.l HWIO_APCS_QTMR_AC_CNTVOFF_LO_1_ADDR A:0xb020088
y.create.l HWIO_APCS_QTMR_AC_CNTVOFF_LO_2_ADDR A:0xb020090
y.create.l HWIO_APCS_QTMR_AC_CNTVOFF_LO_3_ADDR A:0xb020098
y.create.l HWIO_APCS_QTMR_AC_CNTVOFF_LO_4_ADDR A:0xb0200a0
y.create.l HWIO_APCS_QTMR_AC_CNTVOFF_LO_5_ADDR A:0xb0200a8
y.create.l HWIO_APCS_QTMR_AC_CNTVOFF_LO_6_ADDR A:0xb0200b0
y.create.l HWIO_APCS_QTMR_AC_CNTVOFF_HI_0_ADDR A:0xb020084
y.create.l HWIO_APCS_QTMR_AC_CNTVOFF_HI_1_ADDR A:0xb02008c
y.create.l HWIO_APCS_QTMR_AC_CNTVOFF_HI_2_ADDR A:0xb020094
y.create.l HWIO_APCS_QTMR_AC_CNTVOFF_HI_3_ADDR A:0xb02009c
y.create.l HWIO_APCS_QTMR_AC_CNTVOFF_HI_4_ADDR A:0xb0200a4
y.create.l HWIO_APCS_QTMR_AC_CNTVOFF_HI_5_ADDR A:0xb0200ac
y.create.l HWIO_APCS_QTMR_AC_CNTVOFF_HI_6_ADDR A:0xb0200b4
y.create.l HWIO_APCS_QTMR_AC_CFG_ADDR A:0xb020fc0
y.create.l HWIO_APCS_QTMR_AC_VERSION_ADDR A:0xb020fd0
y.create.l HWIO_APCS_F0_QTMR_V1_CNTPCT_LO_ADDR A:0xb021000
y.create.l HWIO_APCS_F0_QTMR_V1_CNTPCT_HI_ADDR A:0xb021004
y.create.l HWIO_APCS_F0_QTMR_V1_CNTVCT_LO_ADDR A:0xb021008
y.create.l HWIO_APCS_F0_QTMR_V1_CNTVCT_HI_ADDR A:0xb02100c
y.create.l HWIO_APCS_F0_QTMR_V1_CNTFRQ_ADDR A:0xb021010
y.create.l HWIO_APCS_F0_QTMR_V1_CNTPL0ACR_ADDR A:0xb021014
y.create.l HWIO_APCS_F0_QTMR_V1_CNTVOFF_LO_ADDR A:0xb021018
y.create.l HWIO_APCS_F0_QTMR_V1_CNTVOFF_HI_ADDR A:0xb02101c
y.create.l HWIO_APCS_F0_QTMR_V1_CNTP_CVAL_LO_ADDR A:0xb021020
y.create.l HWIO_APCS_F0_QTMR_V1_CNTP_CVAL_HI_ADDR A:0xb021024
y.create.l HWIO_APCS_F0_QTMR_V1_CNTP_TVAL_ADDR A:0xb021028
y.create.l HWIO_APCS_F0_QTMR_V1_CNTP_CTL_ADDR A:0xb02102c
y.create.l HWIO_APCS_F0_QTMR_V1_CNTV_CVAL_LO_ADDR A:0xb021030
y.create.l HWIO_APCS_F0_QTMR_V1_CNTV_CVAL_HI_ADDR A:0xb021034
y.create.l HWIO_APCS_F0_QTMR_V1_CNTV_TVAL_ADDR A:0xb021038
y.create.l HWIO_APCS_F0_QTMR_V1_CNTV_CTL_ADDR A:0xb02103c
y.create.l HWIO_APCS_F0_QTMR_V1_VERSION_ADDR A:0xb021fd0
y.create.l HWIO_APCS_F0_QTMR_V2_CNTPCT_LO_ADDR A:0xb022000
y.create.l HWIO_APCS_F0_QTMR_V2_CNTPCT_HI_ADDR A:0xb022004
y.create.l HWIO_APCS_F0_QTMR_V2_CNTVCT_LO_ADDR A:0xb022008
y.create.l HWIO_APCS_F0_QTMR_V2_CNTVCT_HI_ADDR A:0xb02200c
y.create.l HWIO_APCS_F0_QTMR_V2_CNTFRQ_ADDR A:0xb022010
y.create.l HWIO_APCS_F0_QTMR_V2_CNTP_CVAL_LO_ADDR A:0xb022020
y.create.l HWIO_APCS_F0_QTMR_V2_CNTP_CVAL_HI_ADDR A:0xb022024
y.create.l HWIO_APCS_F0_QTMR_V2_CNTP_TVAL_ADDR A:0xb022028
y.create.l HWIO_APCS_F0_QTMR_V2_CNTP_CTL_ADDR A:0xb02202c
y.create.l HWIO_APCS_F0_QTMR_V2_CNTV_CVAL_LO_ADDR A:0xb022030
y.create.l HWIO_APCS_F0_QTMR_V2_CNTV_CVAL_HI_ADDR A:0xb022034
y.create.l HWIO_APCS_F0_QTMR_V2_CNTV_TVAL_ADDR A:0xb022038
y.create.l HWIO_APCS_F0_QTMR_V2_CNTV_CTL_ADDR A:0xb02203c
y.create.l HWIO_APCS_F0_QTMR_V2_VERSION_ADDR A:0xb022fd0
y.create.l HWIO_APCS_F1_QTMR_V1_CNTPCT_LO_ADDR A:0xb023000
y.create.l HWIO_APCS_F1_QTMR_V1_CNTPCT_HI_ADDR A:0xb023004
y.create.l HWIO_APCS_F1_QTMR_V1_CNTVCT_LO_ADDR A:0xb023008
y.create.l HWIO_APCS_F1_QTMR_V1_CNTVCT_HI_ADDR A:0xb02300c
y.create.l HWIO_APCS_F1_QTMR_V1_CNTFRQ_ADDR A:0xb023010
y.create.l HWIO_APCS_F1_QTMR_V1_CNTPL0ACR_ADDR A:0xb023014
y.create.l HWIO_APCS_F1_QTMR_V1_CNTVOFF_LO_ADDR A:0xb023018
y.create.l HWIO_APCS_F1_QTMR_V1_CNTVOFF_HI_ADDR A:0xb02301c
y.create.l HWIO_APCS_F1_QTMR_V1_CNTP_CVAL_LO_ADDR A:0xb023020
y.create.l HWIO_APCS_F1_QTMR_V1_CNTP_CVAL_HI_ADDR A:0xb023024
y.create.l HWIO_APCS_F1_QTMR_V1_CNTP_TVAL_ADDR A:0xb023028
y.create.l HWIO_APCS_F1_QTMR_V1_CNTP_CTL_ADDR A:0xb02302c
y.create.l HWIO_APCS_F1_QTMR_V1_CNTV_CVAL_LO_ADDR A:0xb023030
y.create.l HWIO_APCS_F1_QTMR_V1_CNTV_CVAL_HI_ADDR A:0xb023034
y.create.l HWIO_APCS_F1_QTMR_V1_CNTV_TVAL_ADDR A:0xb023038
y.create.l HWIO_APCS_F1_QTMR_V1_CNTV_CTL_ADDR A:0xb02303c
y.create.l HWIO_APCS_F1_QTMR_V1_VERSION_ADDR A:0xb023fd0
y.create.l HWIO_APCS_F2_QTMR_V1_CNTPCT_LO_ADDR A:0xb024000
y.create.l HWIO_APCS_F2_QTMR_V1_CNTPCT_HI_ADDR A:0xb024004
y.create.l HWIO_APCS_F2_QTMR_V1_CNTVCT_LO_ADDR A:0xb024008
y.create.l HWIO_APCS_F2_QTMR_V1_CNTVCT_HI_ADDR A:0xb02400c
y.create.l HWIO_APCS_F2_QTMR_V1_CNTFRQ_ADDR A:0xb024010
y.create.l HWIO_APCS_F2_QTMR_V1_CNTPL0ACR_ADDR A:0xb024014
y.create.l HWIO_APCS_F2_QTMR_V1_CNTVOFF_LO_ADDR A:0xb024018
y.create.l HWIO_APCS_F2_QTMR_V1_CNTVOFF_HI_ADDR A:0xb02401c
y.create.l HWIO_APCS_F2_QTMR_V1_CNTP_CVAL_LO_ADDR A:0xb024020
y.create.l HWIO_APCS_F2_QTMR_V1_CNTP_CVAL_HI_ADDR A:0xb024024
y.create.l HWIO_APCS_F2_QTMR_V1_CNTP_TVAL_ADDR A:0xb024028
y.create.l HWIO_APCS_F2_QTMR_V1_CNTP_CTL_ADDR A:0xb02402c
y.create.l HWIO_APCS_F2_QTMR_V1_CNTV_CVAL_LO_ADDR A:0xb024030
y.create.l HWIO_APCS_F2_QTMR_V1_CNTV_CVAL_HI_ADDR A:0xb024034
y.create.l HWIO_APCS_F2_QTMR_V1_CNTV_TVAL_ADDR A:0xb024038
y.create.l HWIO_APCS_F2_QTMR_V1_CNTV_CTL_ADDR A:0xb02403c
y.create.l HWIO_APCS_F2_QTMR_V1_VERSION_ADDR A:0xb024fd0
y.create.l HWIO_APCS_F3_QTMR_V1_CNTPCT_LO_ADDR A:0xb025000
y.create.l HWIO_APCS_F3_QTMR_V1_CNTPCT_HI_ADDR A:0xb025004
y.create.l HWIO_APCS_F3_QTMR_V1_CNTVCT_LO_ADDR A:0xb025008
y.create.l HWIO_APCS_F3_QTMR_V1_CNTVCT_HI_ADDR A:0xb02500c
y.create.l HWIO_APCS_F3_QTMR_V1_CNTFRQ_ADDR A:0xb025010
y.create.l HWIO_APCS_F3_QTMR_V1_CNTPL0ACR_ADDR A:0xb025014
y.create.l HWIO_APCS_F3_QTMR_V1_CNTVOFF_LO_ADDR A:0xb025018
y.create.l HWIO_APCS_F3_QTMR_V1_CNTVOFF_HI_ADDR A:0xb02501c
y.create.l HWIO_APCS_F3_QTMR_V1_CNTP_CVAL_LO_ADDR A:0xb025020
y.create.l HWIO_APCS_F3_QTMR_V1_CNTP_CVAL_HI_ADDR A:0xb025024
y.create.l HWIO_APCS_F3_QTMR_V1_CNTP_TVAL_ADDR A:0xb025028
y.create.l HWIO_APCS_F3_QTMR_V1_CNTP_CTL_ADDR A:0xb02502c
y.create.l HWIO_APCS_F3_QTMR_V1_CNTV_CVAL_LO_ADDR A:0xb025030
y.create.l HWIO_APCS_F3_QTMR_V1_CNTV_CVAL_HI_ADDR A:0xb025034
y.create.l HWIO_APCS_F3_QTMR_V1_CNTV_TVAL_ADDR A:0xb025038
y.create.l HWIO_APCS_F3_QTMR_V1_CNTV_CTL_ADDR A:0xb02503c
y.create.l HWIO_APCS_F3_QTMR_V1_VERSION_ADDR A:0xb025fd0
y.create.l HWIO_APCS_F4_QTMR_V1_CNTPCT_LO_ADDR A:0xb026000
y.create.l HWIO_APCS_F4_QTMR_V1_CNTPCT_HI_ADDR A:0xb026004
y.create.l HWIO_APCS_F4_QTMR_V1_CNTVCT_LO_ADDR A:0xb026008
y.create.l HWIO_APCS_F4_QTMR_V1_CNTVCT_HI_ADDR A:0xb02600c
y.create.l HWIO_APCS_F4_QTMR_V1_CNTFRQ_ADDR A:0xb026010
y.create.l HWIO_APCS_F4_QTMR_V1_CNTPL0ACR_ADDR A:0xb026014
y.create.l HWIO_APCS_F4_QTMR_V1_CNTVOFF_LO_ADDR A:0xb026018
y.create.l HWIO_APCS_F4_QTMR_V1_CNTVOFF_HI_ADDR A:0xb02601c
y.create.l HWIO_APCS_F4_QTMR_V1_CNTP_CVAL_LO_ADDR A:0xb026020
y.create.l HWIO_APCS_F4_QTMR_V1_CNTP_CVAL_HI_ADDR A:0xb026024
y.create.l HWIO_APCS_F4_QTMR_V1_CNTP_TVAL_ADDR A:0xb026028
y.create.l HWIO_APCS_F4_QTMR_V1_CNTP_CTL_ADDR A:0xb02602c
y.create.l HWIO_APCS_F4_QTMR_V1_CNTV_CVAL_LO_ADDR A:0xb026030
y.create.l HWIO_APCS_F4_QTMR_V1_CNTV_CVAL_HI_ADDR A:0xb026034
y.create.l HWIO_APCS_F4_QTMR_V1_CNTV_TVAL_ADDR A:0xb026038
y.create.l HWIO_APCS_F4_QTMR_V1_CNTV_CTL_ADDR A:0xb02603c
y.create.l HWIO_APCS_F4_QTMR_V1_VERSION_ADDR A:0xb026fd0
y.create.l HWIO_APCS_F5_QTMR_V1_CNTPCT_LO_ADDR A:0xb027000
y.create.l HWIO_APCS_F5_QTMR_V1_CNTPCT_HI_ADDR A:0xb027004
y.create.l HWIO_APCS_F5_QTMR_V1_CNTVCT_LO_ADDR A:0xb027008
y.create.l HWIO_APCS_F5_QTMR_V1_CNTVCT_HI_ADDR A:0xb02700c
y.create.l HWIO_APCS_F5_QTMR_V1_CNTFRQ_ADDR A:0xb027010
y.create.l HWIO_APCS_F5_QTMR_V1_CNTPL0ACR_ADDR A:0xb027014
y.create.l HWIO_APCS_F5_QTMR_V1_CNTVOFF_LO_ADDR A:0xb027018
y.create.l HWIO_APCS_F5_QTMR_V1_CNTVOFF_HI_ADDR A:0xb02701c
y.create.l HWIO_APCS_F5_QTMR_V1_CNTP_CVAL_LO_ADDR A:0xb027020
y.create.l HWIO_APCS_F5_QTMR_V1_CNTP_CVAL_HI_ADDR A:0xb027024
y.create.l HWIO_APCS_F5_QTMR_V1_CNTP_TVAL_ADDR A:0xb027028
y.create.l HWIO_APCS_F5_QTMR_V1_CNTP_CTL_ADDR A:0xb02702c
y.create.l HWIO_APCS_F5_QTMR_V1_CNTV_CVAL_LO_ADDR A:0xb027030
y.create.l HWIO_APCS_F5_QTMR_V1_CNTV_CVAL_HI_ADDR A:0xb027034
y.create.l HWIO_APCS_F5_QTMR_V1_CNTV_TVAL_ADDR A:0xb027038
y.create.l HWIO_APCS_F5_QTMR_V1_CNTV_CTL_ADDR A:0xb02703c
y.create.l HWIO_APCS_F5_QTMR_V1_VERSION_ADDR A:0xb027fd0
y.create.l HWIO_APCS_F6_QTMR_V1_CNTPCT_LO_ADDR A:0xb028000
y.create.l HWIO_APCS_F6_QTMR_V1_CNTPCT_HI_ADDR A:0xb028004
y.create.l HWIO_APCS_F6_QTMR_V1_CNTVCT_LO_ADDR A:0xb028008
y.create.l HWIO_APCS_F6_QTMR_V1_CNTVCT_HI_ADDR A:0xb02800c
y.create.l HWIO_APCS_F6_QTMR_V1_CNTFRQ_ADDR A:0xb028010
y.create.l HWIO_APCS_F6_QTMR_V1_CNTPL0ACR_ADDR A:0xb028014
y.create.l HWIO_APCS_F6_QTMR_V1_CNTVOFF_LO_ADDR A:0xb028018
y.create.l HWIO_APCS_F6_QTMR_V1_CNTVOFF_HI_ADDR A:0xb02801c
y.create.l HWIO_APCS_F6_QTMR_V1_CNTP_CVAL_LO_ADDR A:0xb028020
y.create.l HWIO_APCS_F6_QTMR_V1_CNTP_CVAL_HI_ADDR A:0xb028024
y.create.l HWIO_APCS_F6_QTMR_V1_CNTP_TVAL_ADDR A:0xb028028
y.create.l HWIO_APCS_F6_QTMR_V1_CNTP_CTL_ADDR A:0xb02802c
y.create.l HWIO_APCS_F6_QTMR_V1_CNTV_CVAL_LO_ADDR A:0xb028030
y.create.l HWIO_APCS_F6_QTMR_V1_CNTV_CVAL_HI_ADDR A:0xb028034
y.create.l HWIO_APCS_F6_QTMR_V1_CNTV_TVAL_ADDR A:0xb028038
y.create.l HWIO_APCS_F6_QTMR_V1_CNTV_CTL_ADDR A:0xb02803c
y.create.l HWIO_APCS_F6_QTMR_V1_VERSION_ADDR A:0xb028fd0
y.create.l HWIO_APCS_VMM_IPC_INTERRUPT_ADDR A:0xb01a004
y.create.l HWIO_APCS_L2_SPM_VOTE_HYP_ADDR A:0xb01a010
y.create.l HWIO_APCS_BANKED_SPM_VOTE_HYP_ADDR A:0xb01a020
y.create.l HWIO_APCS_ALIAS0_SPM_VOTE_HYP_ADDR A:0xb01a030
y.create.l HWIO_APCS_ALIAS1_SPM_VOTE_HYP_ADDR A:0xb01a034
y.create.l HWIO_APCS_ALIAS2_SPM_VOTE_HYP_ADDR A:0xb01a038
y.create.l HWIO_APCS_ALIAS3_SPM_VOTE_HYP_ADDR A:0xb01a03c
y.create.l HWIO_APCS_RBCPR_VERSION_ADDR A:0xb018000
y.create.l HWIO_APCS_RBCPR_SENSOR_MASK0_ADDR A:0xb018020
y.create.l HWIO_APCS_RBCPR_SENSOR_MASK1_ADDR A:0xb018024
y.create.l HWIO_APCS_RBCPR_SENSOR_MASK2_ADDR A:0xb018028
y.create.l HWIO_APCS_RBCPR_SENSOR_MASK3_ADDR A:0xb01802c
y.create.l HWIO_APCS_RBCPR_SENSOR_BYPASS0_ADDR A:0xb018030
y.create.l HWIO_APCS_RBCPR_SENSOR_BYPASS1_ADDR A:0xb018034
y.create.l HWIO_APCS_RBCPR_SENSOR_BYPASS2_ADDR A:0xb018038
y.create.l HWIO_APCS_RBCPR_SENSOR_BYPASS3_ADDR A:0xb01803c
y.create.l HWIO_APCS_RBIF_PMIC_ADDR_ADDR A:0xb018040
y.create.l HWIO_APCS_RBCPR_TIMER_INTERVAL_ADDR A:0xb018044
y.create.l HWIO_APCS_RBIF_LIMIT_ADDR A:0xb018048
y.create.l HWIO_APCS_RBIF_TIMER_ADJUST_ADDR A:0xb01804c
y.create.l HWIO_APCS_RBCPR_GCNT_TARGET0_ADDR A:0xb018060
y.create.l HWIO_APCS_RBCPR_GCNT_TARGET1_ADDR A:0xb018064
y.create.l HWIO_APCS_RBCPR_GCNT_TARGET2_ADDR A:0xb018068
y.create.l HWIO_APCS_RBCPR_GCNT_TARGET3_ADDR A:0xb01806c
y.create.l HWIO_APCS_RBCPR_GCNT_TARGET4_ADDR A:0xb018070
y.create.l HWIO_APCS_RBCPR_GCNT_TARGET5_ADDR A:0xb018074
y.create.l HWIO_APCS_RBCPR_GCNT_TARGET6_ADDR A:0xb018078
y.create.l HWIO_APCS_RBCPR_GCNT_TARGET7_ADDR A:0xb01807c
y.create.l HWIO_APCS_RBCPR_STEP_QUOT_ADDR A:0xb018080
y.create.l HWIO_APCS_RBCPR_CTL_ADDR A:0xb018090
y.create.l HWIO_APCS_RBIF_SW_VLEVEL_ADDR A:0xb018094
y.create.l HWIO_APCS_RBIF_CONT_ACK_CMD_ADDR A:0xb018098
y.create.l HWIO_APCS_RBIF_CONT_NACK_CMD_ADDR A:0xb01809c
y.create.l HWIO_APCS_RBCPR_RESULT_0_ADDR A:0xb0180a0
y.create.l HWIO_APCS_RBCPR_RESULT_1_ADDR A:0xb0180a4
y.create.l HWIO_APCS_RBIF_IRQ_EN_0_ADDR A:0xb018100
y.create.l HWIO_APCS_RBIF_IRQ_EN_1_ADDR A:0xb018104
y.create.l HWIO_APCS_RBIF_IRQ_EN_2_ADDR A:0xb018108
y.create.l HWIO_APCS_RBIF_IRQ_CLEAR_ADDR A:0xb018110
y.create.l HWIO_APCS_RBIF_IRQ_STATUS_ADDR A:0xb018114
y.create.l HWIO_APCS_RBCPR_QUOT_AVG_ADDR A:0xb018118
y.create.l HWIO_APCS_RBCPR_DEBUG0_ADDR A:0xb01811c
y.create.l HWIO_APCS_RBCPR_DEBUG1_ADDR A:0xb018120
y.create.l HWIO_APCS_RBCPR_DEBUG2_ADDR A:0xb018124
y.create.l HWIO_APCS_RBCPR_BIST_MINMAX_ADDR A:0xb018128
y.create.l HWIO_APCS_RBCPR_BIST_RESULT_ADDR A:0xb01812c
y.create.l HWIO_APCS_RBCPR_BIST_FAIL_MAP0_ADDR A:0xb018130
y.create.l HWIO_APCS_RBCPR_BIST_FAIL_MAP1_ADDR A:0xb018134
y.create.l HWIO_APCS_RBCPR_BIST_FAIL_MAP2_ADDR A:0xb018138
y.create.l HWIO_APCS_RBCPR_BIST_FAIL_MAP3_ADDR A:0xb01813c
y.create.l HWIO_APCS_RBCPR_LOG_0_ADDR A:0xb018140
y.create.l HWIO_APCS_RBCPR_LOG_1_ADDR A:0xb018144
y.create.l HWIO_APCS_RBCPR_LOG_2_ADDR A:0xb018148
y.create.l HWIO_APCS_RBCPR_LOG_3_ADDR A:0xb01814c
y.create.l HWIO_APCS_RBCPR_LOG_4_ADDR A:0xb018150
y.create.l HWIO_APCS_RBCPR_LOG_5_ADDR A:0xb018154
y.create.l HWIO_APCS_RBCPR_LOG_6_ADDR A:0xb018158
y.create.l HWIO_APCS_RBCPR_LOG_7_ADDR A:0xb01815c
y.create.l HWIO_APCS_RBCPR_HTOL_AGE_ADDR A:0xb018160
y.create.l HWIO_APCS_WDOG_SECURE_ADDR A:0xb017000
y.create.l HWIO_APCS_WDOG_RESET_ADDR A:0xb017004
y.create.l HWIO_APCS_WDOG_CTL_ADDR A:0xb017008
y.create.l HWIO_APCS_WDOG_STATUS_ADDR A:0xb01700c
y.create.l HWIO_APCS_WDOG_BARK_TIME_ADDR A:0xb017010
y.create.l HWIO_APCS_WDOG_BITE_TIME_ADDR A:0xb017014
y.create.l HWIO_APCS_WDOG_TEST_LOAD_STATUS_ADDR A:0xb017018
y.create.l HWIO_APCS_WDOG_TEST_LOAD_ADDR A:0xb01701c
y.create.l HWIO_APCS_WDOG_TEST_ADDR A:0xb017020
y.create.l HWIO_APCS_SH_PLL_MODE_ADDR A:0xb016000
y.create.l HWIO_APCS_SH_PLL_L_VAL_ADDR A:0xb016004
y.create.l HWIO_APCS_SH_PLL_M_VAL_ADDR A:0xb016008
y.create.l HWIO_APCS_SH_PLL_N_VAL_ADDR A:0xb01600c
y.create.l HWIO_APCS_SH_PLL_USER_CTL_ADDR A:0xb016010
y.create.l HWIO_APCS_SH_PLL_CONFIG_CTL_ADDR A:0xb016014
y.create.l HWIO_APCS_SH_PLL_TEST_CTL_ADDR A:0xb016018
y.create.l HWIO_APCS_SH_PLL_STATUS_ADDR A:0xb01601c
y.create.l HWIO_APCS_SH_PLL_SECURE_ADDR A:0xb016030
y.create.l HWIO_APCS_L2_SAW2_SECURE_ADDR A:0xb012000
y.create.l HWIO_APCS_L2_SAW2_ID_ADDR A:0xb012004
y.create.l HWIO_APCS_L2_SAW2_CFG_ADDR A:0xb012008
y.create.l HWIO_APCS_L2_SAW2_SPM_STS_ADDR A:0xb01200c
y.create.l HWIO_APCS_L2_SAW2_AVS_STS_ADDR A:0xb012010
y.create.l HWIO_APCS_L2_SAW2_PMIC_STS_ADDR A:0xb012014
y.create.l HWIO_APCS_L2_SAW2_RST_ADDR A:0xb012018
y.create.l HWIO_APCS_L2_SAW2_VCTL_ADDR A:0xb01201c
y.create.l HWIO_APCS_L2_SAW2_AVS_CTL_ADDR A:0xb012020
y.create.l HWIO_APCS_L2_SAW2_AVS_LIMIT_ADDR A:0xb012024
y.create.l HWIO_APCS_L2_SAW2_AVS_DLY_ADDR A:0xb012028
y.create.l HWIO_APCS_L2_SAW2_AVS_HYSTERESIS_ADDR A:0xb01202c
y.create.l HWIO_APCS_L2_SAW2_SPM_CTL_ADDR A:0xb012030
y.create.l HWIO_APCS_L2_SAW2_SPM_DLY_ADDR A:0xb012034
y.create.l HWIO_APCS_L2_SAW2_SPM_STS2_ADDR A:0xb012038
y.create.l HWIO_APCS_L2_SAW2_SPM_SLP_SEQ_ENTRY_0_ADDR A:0xb012400
y.create.l HWIO_APCS_L2_SAW2_SPM_SLP_SEQ_ENTRY_1_ADDR A:0xb012404
y.create.l HWIO_APCS_L2_SAW2_SPM_SLP_SEQ_ENTRY_2_ADDR A:0xb012408
y.create.l HWIO_APCS_L2_SAW2_SPM_SLP_SEQ_ENTRY_3_ADDR A:0xb01240c
y.create.l HWIO_APCS_L2_SAW2_SPM_SLP_SEQ_ENTRY_4_ADDR A:0xb012410
y.create.l HWIO_APCS_L2_SAW2_SPM_SLP_SEQ_ENTRY_5_ADDR A:0xb012414
y.create.l HWIO_APCS_L2_SAW2_SPM_SLP_SEQ_ENTRY_6_ADDR A:0xb012418
y.create.l HWIO_APCS_L2_SAW2_SPM_SLP_SEQ_ENTRY_7_ADDR A:0xb01241c
y.create.l HWIO_APCS_L2_SAW2_SPM_SLP_SEQ_ENTRY_8_ADDR A:0xb012420
y.create.l HWIO_APCS_L2_SAW2_SPM_SLP_SEQ_ENTRY_9_ADDR A:0xb012424
y.create.l HWIO_APCS_L2_SAW2_SPM_PMIC_DATA_0_ADDR A:0xb012040
y.create.l HWIO_APCS_L2_SAW2_SPM_PMIC_DATA_1_ADDR A:0xb012044
y.create.l HWIO_APCS_L2_SAW2_SPM_PMIC_DATA_2_ADDR A:0xb012048
y.create.l HWIO_APCS_L2_SAW2_SPM_PMIC_DATA_3_ADDR A:0xb01204c
y.create.l HWIO_APCS_L2_SAW2_SPM_PMIC_DATA_4_ADDR A:0xb012050
y.create.l HWIO_APCS_L2_SAW2_SPM_PMIC_DATA_5_ADDR A:0xb012054
y.create.l HWIO_APCS_L2_SAW2_VERSION_ADDR A:0xb012fd0
y.create.l HWIO_APCS_BANKED_SAW2_SECURE_ADDR A:0xb009000
y.create.l HWIO_APCS_BANKED_SAW2_ID_ADDR A:0xb009004
y.create.l HWIO_APCS_BANKED_SAW2_CFG_ADDR A:0xb009008
y.create.l HWIO_APCS_BANKED_SAW2_SPM_STS_ADDR A:0xb00900c
y.create.l HWIO_APCS_BANKED_SAW2_AVS_STS_ADDR A:0xb009010
y.create.l HWIO_APCS_BANKED_SAW2_PMIC_STS_ADDR A:0xb009014
y.create.l HWIO_APCS_BANKED_SAW2_RST_ADDR A:0xb009018
y.create.l HWIO_APCS_BANKED_SAW2_SPM_CTL_ADDR A:0xb009030
y.create.l HWIO_APCS_BANKED_SAW2_SPM_DLY_ADDR A:0xb009034
y.create.l HWIO_APCS_BANKED_SAW2_SPM_STS2_ADDR A:0xb009038
y.create.l HWIO_APCS_BANKED_SAW2_SPM_SLP_SEQ_ENTRY_0_ADDR A:0xb009400
y.create.l HWIO_APCS_BANKED_SAW2_SPM_SLP_SEQ_ENTRY_1_ADDR A:0xb009404
y.create.l HWIO_APCS_BANKED_SAW2_SPM_SLP_SEQ_ENTRY_2_ADDR A:0xb009408
y.create.l HWIO_APCS_BANKED_SAW2_SPM_SLP_SEQ_ENTRY_3_ADDR A:0xb00940c
y.create.l HWIO_APCS_BANKED_SAW2_SPM_SLP_SEQ_ENTRY_4_ADDR A:0xb009410
y.create.l HWIO_APCS_BANKED_SAW2_SPM_SLP_SEQ_ENTRY_5_ADDR A:0xb009414
y.create.l HWIO_APCS_BANKED_SAW2_SPM_SLP_SEQ_ENTRY_6_ADDR A:0xb009418
y.create.l HWIO_APCS_BANKED_SAW2_SPM_SLP_SEQ_ENTRY_7_ADDR A:0xb00941c
y.create.l HWIO_APCS_BANKED_SAW2_SPM_SLP_SEQ_ENTRY_8_ADDR A:0xb009420
y.create.l HWIO_APCS_BANKED_SAW2_SPM_SLP_SEQ_ENTRY_9_ADDR A:0xb009424
y.create.l HWIO_APCS_BANKED_SAW2_VERSION_ADDR A:0xb009fd0
y.create.l HWIO_APCS_ALIAS0_SAW2_SECURE_ADDR A:0xb089000
y.create.l HWIO_APCS_ALIAS0_SAW2_ID_ADDR A:0xb089004
y.create.l HWIO_APCS_ALIAS0_SAW2_CFG_ADDR A:0xb089008
y.create.l HWIO_APCS_ALIAS0_SAW2_SPM_STS_ADDR A:0xb08900c
y.create.l HWIO_APCS_ALIAS0_SAW2_AVS_STS_ADDR A:0xb089010
y.create.l HWIO_APCS_ALIAS0_SAW2_PMIC_STS_ADDR A:0xb089014
y.create.l HWIO_APCS_ALIAS0_SAW2_RST_ADDR A:0xb089018
y.create.l HWIO_APCS_ALIAS0_SAW2_SPM_CTL_ADDR A:0xb089030
y.create.l HWIO_APCS_ALIAS0_SAW2_SPM_DLY_ADDR A:0xb089034
y.create.l HWIO_APCS_ALIAS0_SAW2_SPM_STS2_ADDR A:0xb089038
y.create.l HWIO_APCS_ALIAS0_SAW2_SPM_SLP_SEQ_ENTRY_0_ADDR A:0xb089400
y.create.l HWIO_APCS_ALIAS0_SAW2_SPM_SLP_SEQ_ENTRY_1_ADDR A:0xb089404
y.create.l HWIO_APCS_ALIAS0_SAW2_SPM_SLP_SEQ_ENTRY_2_ADDR A:0xb089408
y.create.l HWIO_APCS_ALIAS0_SAW2_SPM_SLP_SEQ_ENTRY_3_ADDR A:0xb08940c
y.create.l HWIO_APCS_ALIAS0_SAW2_SPM_SLP_SEQ_ENTRY_4_ADDR A:0xb089410
y.create.l HWIO_APCS_ALIAS0_SAW2_SPM_SLP_SEQ_ENTRY_5_ADDR A:0xb089414
y.create.l HWIO_APCS_ALIAS0_SAW2_SPM_SLP_SEQ_ENTRY_6_ADDR A:0xb089418
y.create.l HWIO_APCS_ALIAS0_SAW2_SPM_SLP_SEQ_ENTRY_7_ADDR A:0xb08941c
y.create.l HWIO_APCS_ALIAS0_SAW2_SPM_SLP_SEQ_ENTRY_8_ADDR A:0xb089420
y.create.l HWIO_APCS_ALIAS0_SAW2_SPM_SLP_SEQ_ENTRY_9_ADDR A:0xb089424
y.create.l HWIO_APCS_ALIAS0_SAW2_VERSION_ADDR A:0xb089fd0
y.create.l HWIO_APCS_ALIAS1_SAW2_SECURE_ADDR A:0xb099000
y.create.l HWIO_APCS_ALIAS1_SAW2_ID_ADDR A:0xb099004
y.create.l HWIO_APCS_ALIAS1_SAW2_CFG_ADDR A:0xb099008
y.create.l HWIO_APCS_ALIAS1_SAW2_SPM_STS_ADDR A:0xb09900c
y.create.l HWIO_APCS_ALIAS1_SAW2_AVS_STS_ADDR A:0xb099010
y.create.l HWIO_APCS_ALIAS1_SAW2_PMIC_STS_ADDR A:0xb099014
y.create.l HWIO_APCS_ALIAS1_SAW2_RST_ADDR A:0xb099018
y.create.l HWIO_APCS_ALIAS1_SAW2_SPM_CTL_ADDR A:0xb099030
y.create.l HWIO_APCS_ALIAS1_SAW2_SPM_DLY_ADDR A:0xb099034
y.create.l HWIO_APCS_ALIAS1_SAW2_SPM_STS2_ADDR A:0xb099038
y.create.l HWIO_APCS_ALIAS1_SAW2_SPM_SLP_SEQ_ENTRY_0_ADDR A:0xb099400
y.create.l HWIO_APCS_ALIAS1_SAW2_SPM_SLP_SEQ_ENTRY_1_ADDR A:0xb099404
y.create.l HWIO_APCS_ALIAS1_SAW2_SPM_SLP_SEQ_ENTRY_2_ADDR A:0xb099408
y.create.l HWIO_APCS_ALIAS1_SAW2_SPM_SLP_SEQ_ENTRY_3_ADDR A:0xb09940c
y.create.l HWIO_APCS_ALIAS1_SAW2_SPM_SLP_SEQ_ENTRY_4_ADDR A:0xb099410
y.create.l HWIO_APCS_ALIAS1_SAW2_SPM_SLP_SEQ_ENTRY_5_ADDR A:0xb099414
y.create.l HWIO_APCS_ALIAS1_SAW2_SPM_SLP_SEQ_ENTRY_6_ADDR A:0xb099418
y.create.l HWIO_APCS_ALIAS1_SAW2_SPM_SLP_SEQ_ENTRY_7_ADDR A:0xb09941c
y.create.l HWIO_APCS_ALIAS1_SAW2_SPM_SLP_SEQ_ENTRY_8_ADDR A:0xb099420
y.create.l HWIO_APCS_ALIAS1_SAW2_SPM_SLP_SEQ_ENTRY_9_ADDR A:0xb099424
y.create.l HWIO_APCS_ALIAS1_SAW2_VERSION_ADDR A:0xb099fd0
y.create.l HWIO_APCS_ALIAS2_SAW2_SECURE_ADDR A:0xb0a9000
y.create.l HWIO_APCS_ALIAS2_SAW2_ID_ADDR A:0xb0a9004
y.create.l HWIO_APCS_ALIAS2_SAW2_CFG_ADDR A:0xb0a9008
y.create.l HWIO_APCS_ALIAS2_SAW2_SPM_STS_ADDR A:0xb0a900c
y.create.l HWIO_APCS_ALIAS2_SAW2_AVS_STS_ADDR A:0xb0a9010
y.create.l HWIO_APCS_ALIAS2_SAW2_PMIC_STS_ADDR A:0xb0a9014
y.create.l HWIO_APCS_ALIAS2_SAW2_RST_ADDR A:0xb0a9018
y.create.l HWIO_APCS_ALIAS2_SAW2_SPM_CTL_ADDR A:0xb0a9030
y.create.l HWIO_APCS_ALIAS2_SAW2_SPM_DLY_ADDR A:0xb0a9034
y.create.l HWIO_APCS_ALIAS2_SAW2_SPM_STS2_ADDR A:0xb0a9038
y.create.l HWIO_APCS_ALIAS2_SAW2_SPM_SLP_SEQ_ENTRY_0_ADDR A:0xb0a9400
y.create.l HWIO_APCS_ALIAS2_SAW2_SPM_SLP_SEQ_ENTRY_1_ADDR A:0xb0a9404
y.create.l HWIO_APCS_ALIAS2_SAW2_SPM_SLP_SEQ_ENTRY_2_ADDR A:0xb0a9408
y.create.l HWIO_APCS_ALIAS2_SAW2_SPM_SLP_SEQ_ENTRY_3_ADDR A:0xb0a940c
y.create.l HWIO_APCS_ALIAS2_SAW2_SPM_SLP_SEQ_ENTRY_4_ADDR A:0xb0a9410
y.create.l HWIO_APCS_ALIAS2_SAW2_SPM_SLP_SEQ_ENTRY_5_ADDR A:0xb0a9414
y.create.l HWIO_APCS_ALIAS2_SAW2_SPM_SLP_SEQ_ENTRY_6_ADDR A:0xb0a9418
y.create.l HWIO_APCS_ALIAS2_SAW2_SPM_SLP_SEQ_ENTRY_7_ADDR A:0xb0a941c
y.create.l HWIO_APCS_ALIAS2_SAW2_SPM_SLP_SEQ_ENTRY_8_ADDR A:0xb0a9420
y.create.l HWIO_APCS_ALIAS2_SAW2_SPM_SLP_SEQ_ENTRY_9_ADDR A:0xb0a9424
y.create.l HWIO_APCS_ALIAS2_SAW2_VERSION_ADDR A:0xb0a9fd0
y.create.l HWIO_APCS_ALIAS3_SAW2_SECURE_ADDR A:0xb0b9000
y.create.l HWIO_APCS_ALIAS3_SAW2_ID_ADDR A:0xb0b9004
y.create.l HWIO_APCS_ALIAS3_SAW2_CFG_ADDR A:0xb0b9008
y.create.l HWIO_APCS_ALIAS3_SAW2_SPM_STS_ADDR A:0xb0b900c
y.create.l HWIO_APCS_ALIAS3_SAW2_AVS_STS_ADDR A:0xb0b9010
y.create.l HWIO_APCS_ALIAS3_SAW2_PMIC_STS_ADDR A:0xb0b9014
y.create.l HWIO_APCS_ALIAS3_SAW2_RST_ADDR A:0xb0b9018
y.create.l HWIO_APCS_ALIAS3_SAW2_SPM_CTL_ADDR A:0xb0b9030
y.create.l HWIO_APCS_ALIAS3_SAW2_SPM_DLY_ADDR A:0xb0b9034
y.create.l HWIO_APCS_ALIAS3_SAW2_SPM_STS2_ADDR A:0xb0b9038
y.create.l HWIO_APCS_ALIAS3_SAW2_SPM_SLP_SEQ_ENTRY_0_ADDR A:0xb0b9400
y.create.l HWIO_APCS_ALIAS3_SAW2_SPM_SLP_SEQ_ENTRY_1_ADDR A:0xb0b9404
y.create.l HWIO_APCS_ALIAS3_SAW2_SPM_SLP_SEQ_ENTRY_2_ADDR A:0xb0b9408
y.create.l HWIO_APCS_ALIAS3_SAW2_SPM_SLP_SEQ_ENTRY_3_ADDR A:0xb0b940c
y.create.l HWIO_APCS_ALIAS3_SAW2_SPM_SLP_SEQ_ENTRY_4_ADDR A:0xb0b9410
y.create.l HWIO_APCS_ALIAS3_SAW2_SPM_SLP_SEQ_ENTRY_5_ADDR A:0xb0b9414
y.create.l HWIO_APCS_ALIAS3_SAW2_SPM_SLP_SEQ_ENTRY_6_ADDR A:0xb0b9418
y.create.l HWIO_APCS_ALIAS3_SAW2_SPM_SLP_SEQ_ENTRY_7_ADDR A:0xb0b941c
y.create.l HWIO_APCS_ALIAS3_SAW2_SPM_SLP_SEQ_ENTRY_8_ADDR A:0xb0b9420
y.create.l HWIO_APCS_ALIAS3_SAW2_SPM_SLP_SEQ_ENTRY_9_ADDR A:0xb0b9424
y.create.l HWIO_APCS_ALIAS3_SAW2_VERSION_ADDR A:0xb0b9fd0
y.create.l HWIO_APCS_GLB_SECURE_ADDR A:0xb011000
y.create.l HWIO_APCS_TZ_IPC_INTERRUPT_ADDR A:0xb011004
y.create.l HWIO_APCS_IPC_INTERRUPT_ADDR A:0xb011008
y.create.l HWIO_APCS_PWR_CTL_OVERRIDE_ADDR A:0xb01100c
y.create.l HWIO_APCS_GLB_CLK_STATUS_ADDR A:0xb011010
y.create.l HWIO_APCS_L2_PWR_CTL_ADDR A:0xb011014
y.create.l HWIO_APCS_L2_PWR_STATUS_ADDR A:0xb011018
y.create.l HWIO_APCS_GLB_CLK_DIAG_ADDR A:0xb01101c
y.create.l HWIO_APCS_GLB_TEST_BUS_SEL_ADDR A:0xb011020
y.create.l HWIO_APCS_DBG_PWR_CTL_ADDR A:0xb011024
y.create.l HWIO_APCS_GLB_SPARE_ADDR A:0xb011028
y.create.l HWIO_APCS_SPARE_STATUS_ADDR A:0xb01102c
y.create.l HWIO_APCS_IDR_ADDR A:0xb011030
y.create.l HWIO_APCS_XO_CBCR_ADDR A:0xb011034
y.create.l HWIO_APCS_SLEEP_CBCR_ADDR A:0xb011038
y.create.l HWIO_APCS_CMD_RCGR_ADDR A:0xb011050
y.create.l HWIO_APCS_CFG_RCGR_ADDR A:0xb011054
y.create.l HWIO_APCS_CORE_CBCR_ADDR A:0xb011058
y.create.l HWIO_APCS_RBCPR_BCR_ADDR A:0xb011060
y.create.l HWIO_APCS_RBCPR_CLK_SEL_ADDR A:0xb011064
y.create.l HWIO_APCS_RBCPR_PMIC_ADDR A:0xb011068
y.create.l HWIO_APCS_A7_CFG_STS_ADDR A:0xb01106c
y.create.l HWIO_APCS_AUX_CLK_ON_ADDR A:0xb011074
y.create.l HWIO_APCS_QSB_LP_ADDR A:0xb011078
y.create.l HWIO_APCS_APPS_BOOTFSM_CTL_ADDR A:0xb011100
y.create.l HWIO_APCS_APPS_BOOTFSM_STATUS_ADDR A:0xb011104
y.create.l HWIO_APCS_L2_SPM_AUX_STARTADDR_ADDR A:0xb011110
y.create.l HWIO_APCS_L2_SPM_VOTE_TZ_ADDR A:0xb011200
y.create.l HWIO_APCS_L2_SPM_VOTE_HLOS_ADDR A:0xb011204
y.create.l HWIO_APCS_L2_SPM_VOTE_INT_STATUS_ADDR A:0xb011208
y.create.l HWIO_APCS_L2_SPM_VOTE_INT_CLEAR_ADDR A:0xb01120c
y.create.l HWIO_APCS_L2_SPM_FORCE_EVENT_EN_ADDR A:0xb011250
y.create.l HWIO_APCS_L2_SPM_FORCE_EVENT_ADDR A:0xb011254
y.create.l HWIO_APCS_L2_SPM_FORCE_PWR_CTL_EN_ADDR A:0xb011258
y.create.l HWIO_APCS_L2_SPM_FORCE_PWR_CTL_ADDR A:0xb01125c
y.create.l HWIO_APCS_L2_SPM_EVENT_STS_ADDR A:0xb011260
y.create.l HWIO_APCS_L2_SPM_PWR_CTL_STS_ADDR A:0xb011264
y.create.l HWIO_APCS_S1LM_SEC_DIVIDER_DIV_VALUE_ADDR A:0xb011300
y.create.l HWIO_APCS_CORE_ARST_APCNSAW_ADDR A:0xb011304
y.create.l HWIO_APCS_VERSION_ADDR A:0xb011fd0
y.create.l HWIO_APCS_CFG_SECURE_ADDR A:0xb010000
y.create.l HWIO_APCS_START_ADDR_SEC_ADDR A:0xb010004
y.create.l HWIO_APCS_START_ADDR_NSEC_ADDR A:0xb010008
y.create.l HWIO_APCS_TCM_START_ADDR_ADDR A:0xb010010
y.create.l HWIO_APCS_BANKED_APC_SECURE_ADDR A:0xb008000
y.create.l HWIO_APCS_BANKED_CPU_PWR_CTL_ADDR A:0xb008004
y.create.l HWIO_APCS_BANKED_APC_A7_CFG_STS_ADDR A:0xb008040
y.create.l HWIO_APCS_BANKED_APC_PWR_STATUS_ADDR A:0xb008008
y.create.l HWIO_APCS_BANKED_APC_TEST_BUS_SEL_ADDR A:0xb00800c
y.create.l HWIO_APCS_BANKED_CPU_TRGTD_DBG_RST_ADDR A:0xb008010
y.create.l HWIO_APCS_BANKED_APC_PWR_GATE_CTL_ADDR A:0xb008014
y.create.l HWIO_APCS_BANKED_APC_PWR_GATE_STATUS_ADDR A:0xb008030
y.create.l HWIO_APCS_BANKED_SPM_AUX_STARTADDR_ADDR A:0xb008044
y.create.l HWIO_APCS_BANKED_SPM_VOTE_TZ_ADDR A:0xb008050
y.create.l HWIO_APCS_BANKED_SPM_VOTE_HLOS_ADDR A:0xb008054
y.create.l HWIO_APCS_BANKED_SPM_VOTE_INT_STATUS_ADDR A:0xb008058
y.create.l HWIO_APCS_BANKED_SPM_VOTE_INT_CLEAR_ADDR A:0xb00805c
y.create.l HWIO_APCS_BANKED_GCC_DBG_CLK_ON_REQ_ADDR A:0xb008060
y.create.l HWIO_APCS_BANKED_SPM_FORCE_EVENT_EN_ADDR A:0xb008070
y.create.l HWIO_APCS_BANKED_SPM_FORCE_EVENT_ADDR A:0xb008074
y.create.l HWIO_APCS_BANKED_SPM_FORCE_PWR_CTL_EN_ADDR A:0xb008078
y.create.l HWIO_APCS_BANKED_SPM_FORCE_PWR_CTL_ADDR A:0xb00807c
y.create.l HWIO_APCS_BANKED_SPM_EVENT_STS_ADDR A:0xb008080
y.create.l HWIO_APCS_BANKED_SPM_PWR_CTL_STS_ADDR A:0xb008084
y.create.l HWIO_APCS_ALIAS0_APC_SECURE_ADDR A:0xb088000
y.create.l HWIO_APCS_ALIAS0_CPU_PWR_CTL_ADDR A:0xb088004
y.create.l HWIO_APCS_ALIAS0_APC_A7_CFG_STS_ADDR A:0xb088040
y.create.l HWIO_APCS_ALIAS0_APC_PWR_STATUS_ADDR A:0xb088008
y.create.l HWIO_APCS_ALIAS0_APC_TEST_BUS_SEL_ADDR A:0xb08800c
y.create.l HWIO_APCS_ALIAS0_CPU_TRGTD_DBG_RST_ADDR A:0xb088010
y.create.l HWIO_APCS_ALIAS0_APC_PWR_GATE_CTL_ADDR A:0xb088014
y.create.l HWIO_APCS_ALIAS0_APC_PWR_GATE_STATUS_ADDR A:0xb088030
y.create.l HWIO_APCS_ALIAS0_SPM_AUX_STARTADDR_ADDR A:0xb088044
y.create.l HWIO_APCS_ALIAS0_SPM_VOTE_TZ_ADDR A:0xb088050
y.create.l HWIO_APCS_ALIAS0_SPM_VOTE_HLOS_ADDR A:0xb088054
y.create.l HWIO_APCS_ALIAS0_SPM_VOTE_INT_STATUS_ADDR A:0xb088058
y.create.l HWIO_APCS_ALIAS0_SPM_VOTE_INT_CLEAR_ADDR A:0xb08805c
y.create.l HWIO_APCS_ALIAS0_GCC_DBG_CLK_ON_REQ_ADDR A:0xb088060
y.create.l HWIO_APCS_ALIAS0_SPM_FORCE_EVENT_EN_ADDR A:0xb088070
y.create.l HWIO_APCS_ALIAS0_SPM_FORCE_EVENT_ADDR A:0xb088074
y.create.l HWIO_APCS_ALIAS0_SPM_FORCE_PWR_CTL_EN_ADDR A:0xb088078
y.create.l HWIO_APCS_ALIAS0_SPM_FORCE_PWR_CTL_ADDR A:0xb08807c
y.create.l HWIO_APCS_ALIAS0_SPM_EVENT_STS_ADDR A:0xb088080
y.create.l HWIO_APCS_ALIAS0_SPM_PWR_CTL_STS_ADDR A:0xb088084
y.create.l HWIO_APCS_ALIAS1_APC_SECURE_ADDR A:0xb098000
y.create.l HWIO_APCS_ALIAS1_CPU_PWR_CTL_ADDR A:0xb098004
y.create.l HWIO_APCS_ALIAS1_APC_A7_CFG_STS_ADDR A:0xb098040
y.create.l HWIO_APCS_ALIAS1_APC_PWR_STATUS_ADDR A:0xb098008
y.create.l HWIO_APCS_ALIAS1_APC_TEST_BUS_SEL_ADDR A:0xb09800c
y.create.l HWIO_APCS_ALIAS1_CPU_TRGTD_DBG_RST_ADDR A:0xb098010
y.create.l HWIO_APCS_ALIAS1_APC_PWR_GATE_CTL_ADDR A:0xb098014
y.create.l HWIO_APCS_ALIAS1_APC_PWR_GATE_STATUS_ADDR A:0xb098030
y.create.l HWIO_APCS_ALIAS1_SPM_AUX_STARTADDR_ADDR A:0xb098044
y.create.l HWIO_APCS_ALIAS1_SPM_VOTE_TZ_ADDR A:0xb098050
y.create.l HWIO_APCS_ALIAS1_SPM_VOTE_HLOS_ADDR A:0xb098054
y.create.l HWIO_APCS_ALIAS1_SPM_VOTE_INT_STATUS_ADDR A:0xb098058
y.create.l HWIO_APCS_ALIAS1_SPM_VOTE_INT_CLEAR_ADDR A:0xb09805c
y.create.l HWIO_APCS_ALIAS1_GCC_DBG_CLK_ON_REQ_ADDR A:0xb098060
y.create.l HWIO_APCS_ALIAS1_SPM_FORCE_EVENT_EN_ADDR A:0xb098070
y.create.l HWIO_APCS_ALIAS1_SPM_FORCE_EVENT_ADDR A:0xb098074
y.create.l HWIO_APCS_ALIAS1_SPM_FORCE_PWR_CTL_EN_ADDR A:0xb098078
y.create.l HWIO_APCS_ALIAS1_SPM_FORCE_PWR_CTL_ADDR A:0xb09807c
y.create.l HWIO_APCS_ALIAS1_SPM_EVENT_STS_ADDR A:0xb098080
y.create.l HWIO_APCS_ALIAS1_SPM_PWR_CTL_STS_ADDR A:0xb098084
y.create.l HWIO_APCS_ALIAS2_APC_SECURE_ADDR A:0xb0a8000
y.create.l HWIO_APCS_ALIAS2_CPU_PWR_CTL_ADDR A:0xb0a8004
y.create.l HWIO_APCS_ALIAS2_APC_A7_CFG_STS_ADDR A:0xb0a8040
y.create.l HWIO_APCS_ALIAS2_APC_PWR_STATUS_ADDR A:0xb0a8008
y.create.l HWIO_APCS_ALIAS2_APC_TEST_BUS_SEL_ADDR A:0xb0a800c
y.create.l HWIO_APCS_ALIAS2_CPU_TRGTD_DBG_RST_ADDR A:0xb0a8010
y.create.l HWIO_APCS_ALIAS2_APC_PWR_GATE_CTL_ADDR A:0xb0a8014
y.create.l HWIO_APCS_ALIAS2_APC_PWR_GATE_STATUS_ADDR A:0xb0a8030
y.create.l HWIO_APCS_ALIAS2_SPM_AUX_STARTADDR_ADDR A:0xb0a8044
y.create.l HWIO_APCS_ALIAS2_SPM_VOTE_TZ_ADDR A:0xb0a8050
y.create.l HWIO_APCS_ALIAS2_SPM_VOTE_HLOS_ADDR A:0xb0a8054
y.create.l HWIO_APCS_ALIAS2_SPM_VOTE_INT_STATUS_ADDR A:0xb0a8058
y.create.l HWIO_APCS_ALIAS2_SPM_VOTE_INT_CLEAR_ADDR A:0xb0a805c
y.create.l HWIO_APCS_ALIAS2_GCC_DBG_CLK_ON_REQ_ADDR A:0xb0a8060
y.create.l HWIO_APCS_ALIAS2_SPM_FORCE_EVENT_EN_ADDR A:0xb0a8070
y.create.l HWIO_APCS_ALIAS2_SPM_FORCE_EVENT_ADDR A:0xb0a8074
y.create.l HWIO_APCS_ALIAS2_SPM_FORCE_PWR_CTL_EN_ADDR A:0xb0a8078
y.create.l HWIO_APCS_ALIAS2_SPM_FORCE_PWR_CTL_ADDR A:0xb0a807c
y.create.l HWIO_APCS_ALIAS2_SPM_EVENT_STS_ADDR A:0xb0a8080
y.create.l HWIO_APCS_ALIAS2_SPM_PWR_CTL_STS_ADDR A:0xb0a8084
y.create.l HWIO_APCS_ALIAS3_APC_SECURE_ADDR A:0xb0b8000
y.create.l HWIO_APCS_ALIAS3_CPU_PWR_CTL_ADDR A:0xb0b8004
y.create.l HWIO_APCS_ALIAS3_APC_A7_CFG_STS_ADDR A:0xb0b8040
y.create.l HWIO_APCS_ALIAS3_APC_PWR_STATUS_ADDR A:0xb0b8008
y.create.l HWIO_APCS_ALIAS3_APC_TEST_BUS_SEL_ADDR A:0xb0b800c
y.create.l HWIO_APCS_ALIAS3_CPU_TRGTD_DBG_RST_ADDR A:0xb0b8010
y.create.l HWIO_APCS_ALIAS3_APC_PWR_GATE_CTL_ADDR A:0xb0b8014
y.create.l HWIO_APCS_ALIAS3_APC_PWR_GATE_STATUS_ADDR A:0xb0b8030
y.create.l HWIO_APCS_ALIAS3_SPM_AUX_STARTADDR_ADDR A:0xb0b8044
y.create.l HWIO_APCS_ALIAS3_SPM_VOTE_TZ_ADDR A:0xb0b8050
y.create.l HWIO_APCS_ALIAS3_SPM_VOTE_HLOS_ADDR A:0xb0b8054
y.create.l HWIO_APCS_ALIAS3_SPM_VOTE_INT_STATUS_ADDR A:0xb0b8058
y.create.l HWIO_APCS_ALIAS3_SPM_VOTE_INT_CLEAR_ADDR A:0xb0b805c
y.create.l HWIO_APCS_ALIAS3_GCC_DBG_CLK_ON_REQ_ADDR A:0xb0b8060
y.create.l HWIO_APCS_ALIAS3_SPM_FORCE_EVENT_EN_ADDR A:0xb0b8070
y.create.l HWIO_APCS_ALIAS3_SPM_FORCE_EVENT_ADDR A:0xb0b8074
y.create.l HWIO_APCS_ALIAS3_SPM_FORCE_PWR_CTL_EN_ADDR A:0xb0b8078
y.create.l HWIO_APCS_ALIAS3_SPM_FORCE_PWR_CTL_ADDR A:0xb0b807c
y.create.l HWIO_APCS_ALIAS3_SPM_EVENT_STS_ADDR A:0xb0b8080
y.create.l HWIO_APCS_ALIAS3_SPM_PWR_CTL_STS_ADDR A:0xb0b8084
y.create.l HWIO_APCS_GICD_CTLR_ADDR A:0xb000000
y.create.l HWIO_APCS_GICD_TYPER_ADDR A:0xb000004
y.create.l HWIO_APCS_GICD_IIDR_ADDR A:0xb000008
y.create.l HWIO_APCS_GICD_ANSACR_ADDR A:0xb000020
y.create.l HWIO_APCS_GICD_CGCR_ADDR A:0xb000024
y.create.l HWIO_APCS_GICD_HW_VERSION_ADDR A:0xb000030
y.create.l HWIO_APCS_GICD_ISR0_ADDR A:0xb000080
y.create.l HWIO_APCS_GICD_ISR1_ADDR A:0xb000084
y.create.l HWIO_APCS_GICD_ISR2_ADDR A:0xb000088
y.create.l HWIO_APCS_GICD_ISR3_ADDR A:0xb00008c
y.create.l HWIO_APCS_GICD_ISR4_ADDR A:0xb000090
y.create.l HWIO_APCS_GICD_ISR5_ADDR A:0xb000094
y.create.l HWIO_APCS_GICD_ISR6_ADDR A:0xb000098
y.create.l HWIO_APCS_GICD_ISR7_ADDR A:0xb00009c
y.create.l HWIO_APCS_GICD_ISR8_ADDR A:0xb0000a0
y.create.l HWIO_APCS_GICD_ISENABLER0_ADDR A:0xb000100
y.create.l HWIO_APCS_GICD_ISENABLER1_ADDR A:0xb000104
y.create.l HWIO_APCS_GICD_ISENABLER2_ADDR A:0xb000108
y.create.l HWIO_APCS_GICD_ISENABLER3_ADDR A:0xb00010c
y.create.l HWIO_APCS_GICD_ISENABLER4_ADDR A:0xb000110
y.create.l HWIO_APCS_GICD_ISENABLER5_ADDR A:0xb000114
y.create.l HWIO_APCS_GICD_ISENABLER6_ADDR A:0xb000118
y.create.l HWIO_APCS_GICD_ISENABLER7_ADDR A:0xb00011c
y.create.l HWIO_APCS_GICD_ISENABLER8_ADDR A:0xb000120
y.create.l HWIO_APCS_GICD_ICENABLER0_ADDR A:0xb000180
y.create.l HWIO_APCS_GICD_ICENABLER1_ADDR A:0xb000184
y.create.l HWIO_APCS_GICD_ICENABLER2_ADDR A:0xb000188
y.create.l HWIO_APCS_GICD_ICENABLER3_ADDR A:0xb00018c
y.create.l HWIO_APCS_GICD_ICENABLER4_ADDR A:0xb000190
y.create.l HWIO_APCS_GICD_ICENABLER5_ADDR A:0xb000194
y.create.l HWIO_APCS_GICD_ICENABLER6_ADDR A:0xb000198
y.create.l HWIO_APCS_GICD_ICENABLER7_ADDR A:0xb00019c
y.create.l HWIO_APCS_GICD_ICENABLER8_ADDR A:0xb0001a0
y.create.l HWIO_APCS_GICD_ISPENDR0_ADDR A:0xb000200
y.create.l HWIO_APCS_GICD_ISPENDR1_ADDR A:0xb000204
y.create.l HWIO_APCS_GICD_ISPENDR2_ADDR A:0xb000208
y.create.l HWIO_APCS_GICD_ISPENDR3_ADDR A:0xb00020c
y.create.l HWIO_APCS_GICD_ISPENDR4_ADDR A:0xb000210
y.create.l HWIO_APCS_GICD_ISPENDR5_ADDR A:0xb000214
y.create.l HWIO_APCS_GICD_ISPENDR6_ADDR A:0xb000218
y.create.l HWIO_APCS_GICD_ISPENDR7_ADDR A:0xb00021c
y.create.l HWIO_APCS_GICD_ISPENDR8_ADDR A:0xb000220
y.create.l HWIO_APCS_GICD_ICPENDR0_ADDR A:0xb000280
y.create.l HWIO_APCS_GICD_ICPENDR1_ADDR A:0xb000284
y.create.l HWIO_APCS_GICD_ICPENDR2_ADDR A:0xb000288
y.create.l HWIO_APCS_GICD_ICPENDR3_ADDR A:0xb00028c
y.create.l HWIO_APCS_GICD_ICPENDR4_ADDR A:0xb000290
y.create.l HWIO_APCS_GICD_ICPENDR5_ADDR A:0xb000294
y.create.l HWIO_APCS_GICD_ICPENDR6_ADDR A:0xb000298
y.create.l HWIO_APCS_GICD_ICPENDR7_ADDR A:0xb00029c
y.create.l HWIO_APCS_GICD_ICPENDR8_ADDR A:0xb0002a0
y.create.l HWIO_APCS_GICD_ISACTIVER0_ADDR A:0xb000300
y.create.l HWIO_APCS_GICD_ISACTIVER1_ADDR A:0xb000304
y.create.l HWIO_APCS_GICD_ISACTIVER2_ADDR A:0xb000308
y.create.l HWIO_APCS_GICD_ISACTIVER3_ADDR A:0xb00030c
y.create.l HWIO_APCS_GICD_ISACTIVER4_ADDR A:0xb000310
y.create.l HWIO_APCS_GICD_ISACTIVER5_ADDR A:0xb000314
y.create.l HWIO_APCS_GICD_ISACTIVER6_ADDR A:0xb000318
y.create.l HWIO_APCS_GICD_ISACTIVER7_ADDR A:0xb00031c
y.create.l HWIO_APCS_GICD_ISACTIVER8_ADDR A:0xb000320
y.create.l HWIO_APCS_GICD_ICACTIVER0_ADDR A:0xb000380
y.create.l HWIO_APCS_GICD_ICACTIVER1_ADDR A:0xb000384
y.create.l HWIO_APCS_GICD_ICACTIVER2_ADDR A:0xb000388
y.create.l HWIO_APCS_GICD_ICACTIVER3_ADDR A:0xb00038c
y.create.l HWIO_APCS_GICD_ICACTIVER4_ADDR A:0xb000390
y.create.l HWIO_APCS_GICD_ICACTIVER5_ADDR A:0xb000394
y.create.l HWIO_APCS_GICD_ICACTIVER6_ADDR A:0xb000398
y.create.l HWIO_APCS_GICD_ICACTIVER7_ADDR A:0xb00039c
y.create.l HWIO_APCS_GICD_ICACTIVER8_ADDR A:0xb0003a0
y.create.l HWIO_APCS_GICD_IPRIORITYR0_ADDR A:0xb000400
y.create.l HWIO_APCS_GICD_IPRIORITYR1_ADDR A:0xb000404
y.create.l HWIO_APCS_GICD_IPRIORITYR2_ADDR A:0xb000408
y.create.l HWIO_APCS_GICD_IPRIORITYR3_ADDR A:0xb00040c
y.create.l HWIO_APCS_GICD_IPRIORITYR4_ADDR A:0xb000410
y.create.l HWIO_APCS_GICD_IPRIORITYR5_ADDR A:0xb000414
y.create.l HWIO_APCS_GICD_IPRIORITYR6_ADDR A:0xb000418
y.create.l HWIO_APCS_GICD_IPRIORITYR7_ADDR A:0xb00041c
y.create.l HWIO_APCS_GICD_IPRIORITYR8_ADDR A:0xb000420
y.create.l HWIO_APCS_GICD_IPRIORITYR9_ADDR A:0xb000424
y.create.l HWIO_APCS_GICD_ITARGETSR0_ADDR A:0xb000800
y.create.l HWIO_APCS_GICD_ITARGETSR1_ADDR A:0xb000804
y.create.l HWIO_APCS_GICD_ITARGETSR2_ADDR A:0xb000808
y.create.l HWIO_APCS_GICD_ITARGETSR3_ADDR A:0xb00080c
y.create.l HWIO_APCS_GICD_ITARGETSR4_ADDR A:0xb000810
y.create.l HWIO_APCS_GICD_ITARGETSR5_ADDR A:0xb000814
y.create.l HWIO_APCS_GICD_ITARGETSR6_ADDR A:0xb000818
y.create.l HWIO_APCS_GICD_ITARGETSR7_ADDR A:0xb00081c
y.create.l HWIO_APCS_GICD_ITARGETSR8_ADDR A:0xb000820
y.create.l HWIO_APCS_GICD_ITARGETSR9_ADDR A:0xb000824
y.create.l HWIO_APCS_GICD_ICFGR0_ADDR A:0xb000c00
y.create.l HWIO_APCS_GICD_ICFGR1_ADDR A:0xb000c04
y.create.l HWIO_APCS_GICD_ICFGR2_ADDR A:0xb000c08
y.create.l HWIO_APCS_GICD_ICFGR3_ADDR A:0xb000c0c
y.create.l HWIO_APCS_GICD_ICFGR4_ADDR A:0xb000c10
y.create.l HWIO_APCS_GICD_ICFGR5_ADDR A:0xb000c14
y.create.l HWIO_APCS_GICD_ICFGR6_ADDR A:0xb000c18
y.create.l HWIO_APCS_GICD_ICFGR7_ADDR A:0xb000c1c
y.create.l HWIO_APCS_GICD_ICFGR8_ADDR A:0xb000c20
y.create.l HWIO_APCS_GICD_ICFGR9_ADDR A:0xb000c24
y.create.l HWIO_APCS_GICD_SGIR_ADDR A:0xb000f00
y.create.l HWIO_APCS_GICD_CPENDSGIR0_ADDR A:0xb000f10
y.create.l HWIO_APCS_GICD_CPENDSGIR1_ADDR A:0xb000f14
y.create.l HWIO_APCS_GICD_CPENDSGIR2_ADDR A:0xb000f18
y.create.l HWIO_APCS_GICD_CPENDSGIR3_ADDR A:0xb000f1c
y.create.l HWIO_APCS_GICD_SPENDSGIR0_ADDR A:0xb000f20
y.create.l HWIO_APCS_GICD_SPENDSGIR1_ADDR A:0xb000f24
y.create.l HWIO_APCS_GICD_SPENDSGIR2_ADDR A:0xb000f28
y.create.l HWIO_APCS_GICD_SPENDSGIR3_ADDR A:0xb000f2c
y.create.l HWIO_APCS_GICD_PIDR0_ADDR A:0xb000fd0
y.create.l HWIO_APCS_GICD_PIDR1_ADDR A:0xb000fd4
y.create.l HWIO_APCS_GICD_PIDR2_ADDR A:0xb000fd8
y.create.l HWIO_APCS_GICD_PIDR3_ADDR A:0xb000fdc
y.create.l HWIO_APCS_GICD_PIDR4_ADDR A:0xb000fe0
y.create.l HWIO_APCS_GICD_PIDR5_ADDR A:0xb000fe4
y.create.l HWIO_APCS_GICD_PIDR6_ADDR A:0xb000fe8
y.create.l HWIO_APCS_GICD_PIDR7_ADDR A:0xb000fec
y.create.l HWIO_APCS_GICD_CIDR0_ADDR A:0xb000ff0
y.create.l HWIO_APCS_GICD_CIDR1_ADDR A:0xb000ff4
y.create.l HWIO_APCS_GICD_CIDR2_ADDR A:0xb000ff8
y.create.l HWIO_APCS_GICD_CIDR3_ADDR A:0xb000ffc
y.create.l HWIO_APCS_GICH_HCR_ADDR A:0xb001000
y.create.l HWIO_APCS_GICH_VTR_ADDR A:0xb001004
y.create.l HWIO_APCS_GICH_VMCR_ADDR A:0xb001008
y.create.l HWIO_APCS_GICH_MISR_ADDR A:0xb001010
y.create.l HWIO_APCS_GICH_EISR_ADDR A:0xb001020
y.create.l HWIO_APCS_GICH_ELRSR_ADDR A:0xb001030
y.create.l HWIO_APCS_GICH_APR_ADDR A:0xb0010f0
y.create.l HWIO_APCS_GICH_LR0_ADDR A:0xb001100
y.create.l HWIO_APCS_GICH_LR1_ADDR A:0xb001104
y.create.l HWIO_APCS_GICH_LR2_ADDR A:0xb001108
y.create.l HWIO_APCS_GICH_LR3_ADDR A:0xb00110c
y.create.l HWIO_APCS_GICH_SW_LR_ADDR A:0xb001120
y.create.l HWIO_APCS_GICC_CTLR_ADDR A:0xb002000
y.create.l HWIO_APCS_GICC_PMR_ADDR A:0xb002004
y.create.l HWIO_APCS_GICC_BPR_ADDR A:0xb002008
y.create.l HWIO_APCS_GICC_IAR_ADDR A:0xb00200c
y.create.l HWIO_APCS_GICC_EOIR_ADDR A:0xb002010
y.create.l HWIO_APCS_GICC_RPR_ADDR A:0xb002014
y.create.l HWIO_APCS_GICC_HPPIR_ADDR A:0xb002018
y.create.l HWIO_APCS_GICC_ABPR_ADDR A:0xb00201c
y.create.l HWIO_APCS_GICC_AIAR_ADDR A:0xb002020
y.create.l HWIO_APCS_GICC_AEOIR_ADDR A:0xb002024
y.create.l HWIO_APCS_GICC_AHPPIR_ADDR A:0xb002028
y.create.l HWIO_APCS_GICC_APR_ADDR A:0xb0020d0
y.create.l HWIO_APCS_GICC_NSAPR_ADDR A:0xb0020e0
y.create.l HWIO_APCS_GICC_IIDR_ADDR A:0xb0020fc
y.create.l HWIO_APCS_GICC_DIR_ADDR A:0xb003000
y.create.l HWIO_APCS_GICV_CTLR_ADDR A:0xb004000
y.create.l HWIO_APCS_GICV_PMR_ADDR A:0xb004004
y.create.l HWIO_APCS_GICV_BPR_ADDR A:0xb004008
y.create.l HWIO_APCS_GICV_IAR_ADDR A:0xb00400c
y.create.l HWIO_APCS_GICV_EOIR_ADDR A:0xb004010
y.create.l HWIO_APCS_GICV_RPR_ADDR A:0xb004014
y.create.l HWIO_APCS_GICV_HPPIR_ADDR A:0xb004018
y.create.l HWIO_APCS_GICV_ABPR_ADDR A:0xb00401c
y.create.l HWIO_APCS_GICV_AIAR_ADDR A:0xb004020
y.create.l HWIO_APCS_GICV_AEOIR_ADDR A:0xb004024
y.create.l HWIO_APCS_GICV_AHPPIR_ADDR A:0xb004028
y.create.l HWIO_APCS_GICV_APR_ADDR A:0xb0040d0
y.create.l HWIO_APCS_GICV_IIDR_ADDR A:0xb0040fc
y.create.l HWIO_APCS_GICV_DIR_ADDR A:0xb005000
y.create.l HWIO_BIMC_HW_VERSION_ADDR A:0x400000
y.create.l HWIO_BIMC_CORE_INFO_ADDR A:0x400004
y.create.l HWIO_BIMC_HW_INFO_ADDR A:0x400008
y.create.l HWIO_BIMC_DDR_CH0_CLK_2X_MODE_ADDR A:0x400020
y.create.l HWIO_BIMC_DDR_CH0_CLK_PERIOD_ADDR A:0x400028
y.create.l HWIO_BIMC_DDR_CH0_PHY_CLK_SEL_ADDR A:0x400030
y.create.l HWIO_BIMC_SCMO0_LOCAL_CGC_THRESHOLD_ADDR A:0x400100
y.create.l HWIO_BIMC_DPE0_LOCAL_CGC_THRESHOLD_ADDR A:0x400140
y.create.l HWIO_BIMC_MPORT_CORE_DOMAIN_LOCAL_CGC_THRESHOLD_ADDR A:0x400180
y.create.l HWIO_BIMC_MPORT0_CLK_LOCAL_CGC_THRESHOLD_ADDR A:0x4001c0
y.create.l HWIO_BIMC_MPORT1_CLK_LOCAL_CGC_THRESHOLD_ADDR A:0x4001c4
y.create.l HWIO_BIMC_MPORT2_CLK_LOCAL_CGC_THRESHOLD_ADDR A:0x4001c8
y.create.l HWIO_BIMC_MPORT3_CLK_LOCAL_CGC_THRESHOLD_ADDR A:0x4001cc
y.create.l HWIO_BIMC_MPORT4_CLK_LOCAL_CGC_THRESHOLD_ADDR A:0x4001d0
y.create.l HWIO_BIMC_MPORT5_CLK_LOCAL_CGC_THRESHOLD_ADDR A:0x4001d4
y.create.l HWIO_BIMC_MPORT6_CLK_LOCAL_CGC_THRESHOLD_ADDR A:0x4001d8
y.create.l HWIO_BIMC_SWAY_LOCAL_CGC_THRESHOLD_ADDR A:0x400200
y.create.l HWIO_BIMC_SCMO0_CGC_CFG_ADDR A:0x400240
y.create.l HWIO_BIMC_DPE0_CGC_CFG_ADDR A:0x400280
y.create.l HWIO_BIMC_DDR_CH0_CAL_CFG_0_ADDR A:0x400400
y.create.l HWIO_BIMC_DDR_CH0_CAL_CFG_1_ADDR A:0x400410
y.create.l HWIO_BIMC_DDR_CH0_CAL_CFG_2_ADDR A:0x400420
y.create.l HWIO_BIMC_DDR_CH0_CAL_CFG_3_ADDR A:0x400428
y.create.l HWIO_BIMC_DDR_CH0_SW_CAL_ENA_ADDR A:0x400430
y.create.l HWIO_BIMC_DDR_CH0_SW_CLKEN_DDRCC_ADDR A:0x400438
y.create.l HWIO_BIMC_DDR_CH0_SW_CLKEN_CAPHY_ADDR A:0x400440
y.create.l HWIO_BIMC_DDR_CH0_SW_CLKEN_DQPHY_ADDR A:0x400448
y.create.l HWIO_BIMC_DDR_CH0_SW_CLK_READY_OVERRIDE_ADDR A:0x400450
y.create.l HWIO_BIMC_DDR_CH0_DDRCC_CLK_EXTEND_ADDR A:0x400460
y.create.l HWIO_BIMC_DDR_CH0_CAPHY_CLK_EXTEND_ADDR A:0x400470
y.create.l HWIO_BIMC_DDR_CH0_DQPHY_CLK_EXTEND_ADDR A:0x400480
y.create.l HWIO_BIMC_DFI0_LP_CFG_ADDR A:0x400600
y.create.l HWIO_BIMC_DDR_CH0_HFSC_CFG_ADDR A:0x400800
y.create.l HWIO_BIMC_DDR_CH0_HFSC_STATUS_ADDR A:0x400810
y.create.l HWIO_BIMC_DDR_CH0_HFSC_STAGE1_CTRL_ADDR A:0x400820
y.create.l HWIO_BIMC_DDR_CH0_HFSC_STAGE2_CTRL_ADDR A:0x400830
y.create.l HWIO_BIMC_DDR_CH0_HFSC_STAGE1_HANDSHAKE_CTRL_ADDR A:0x400840
y.create.l HWIO_BIMC_DDR_CH0_HFSC_STAGE2_HANDSHAKE_CTRL_ADDR A:0x400850
y.create.l HWIO_BIMC_QOS_CTRL_ADDR A:0x400900
y.create.l HWIO_BIMC_QOS_CFG_ADDR A:0x400904
y.create.l HWIO_BIMC_QOS_TIMEOUT_CNT_LOW_URGENCY_ADDR A:0x400908
y.create.l HWIO_BIMC_QOS_TIMEOUT_CNT_HIGH_URGENCY_ADDR A:0x40090c
y.create.l HWIO_BIMC_QOS_STATUS_ADDR A:0x400910
y.create.l HWIO_BIMC_QOS_STATUS_CLR_ADDR A:0x400914
y.create.l HWIO_BIMC_QOS_FSSH_CTRL_ADDR A:0x400920
y.create.l HWIO_BIMC_QOS_FSSH_FREQ_THRESHOLD_URGENCY_BAND0_ADDR A:0x400930
y.create.l HWIO_BIMC_QOS_FSSH_URGENCY_SEL_ADDR A:0x400940
y.create.l HWIO_BIMC_BRIC_GLOBAL1_COMPONENT_INFO_ADDR A:0x401000
y.create.l HWIO_BIMC_BRIC_HW_INFO_ADDR A:0x401010
y.create.l HWIO_BIMC_BRIC_HW_VERSION_ADDR A:0x401014
y.create.l HWIO_BIMC_BRIC_CONFIGURATION_INFO_0_ADDR A:0x401020
y.create.l HWIO_BIMC_BRIC_CONFIGURATION_INFO_1_ADDR A:0x401030
y.create.l HWIO_BIMC_BRIC_CONFIGURATION_INFO_2A_ADDR A:0x401040
y.create.l HWIO_BIMC_BRIC_CONFIGURATION_INFO_2B_ADDR A:0x401044
y.create.l HWIO_BIMC_BRIC_CONFIGURATION_INFO_2C_ADDR A:0x401048
y.create.l HWIO_BIMC_BRIC_CONFIGURATION_INFO_2D_ADDR A:0x40104c
y.create.l HWIO_BIMC_BRIC_INTERRUPT_STATUS_0_ADDR A:0x401100
y.create.l HWIO_BIMC_BRIC_INTERRUPT_CLEAR_0_ADDR A:0x401108
y.create.l HWIO_BIMC_BRIC_INTERRUPT_ENABLE_0_ADDR A:0x40110c
y.create.l HWIO_BIMC_BRIC_INTERRUPT_STATUS_1_ADDR A:0x401110
y.create.l HWIO_BIMC_BRIC_INTERRUPT_CLEAR_1_ADDR A:0x401118
y.create.l HWIO_BIMC_BRIC_INTERRUPT_ENABLE_1_ADDR A:0x40111c
y.create.l HWIO_BIMC_BRIC_INTERRUPT_STATUS_2_ADDR A:0x401120
y.create.l HWIO_BIMC_BRIC_INTERRUPT_CLEAR_2_ADDR A:0x401128
y.create.l HWIO_BIMC_BRIC_INTERRUPT_ENABLE_2_ADDR A:0x40112c
y.create.l HWIO_BIMC_BRIC_INTERRUPT_STATUS_3_ADDR A:0x401130
y.create.l HWIO_BIMC_BRIC_INTERRUPT_CLEAR_3_ADDR A:0x401138
y.create.l HWIO_BIMC_BRIC_INTERRUPT_ENABLE_3_ADDR A:0x40113c
y.create.l HWIO_BIMC_BRIC_REF_TIMER_INTERVAL_ADDR A:0x401200
y.create.l HWIO_BIMC_BRIC_DEBUG_SELECT_ADDR A:0x401210
y.create.l HWIO_BIMC_BRIC_MSA_LOCKS_ADDR A:0x401300
y.create.l HWIO_BIMC_BRIC_PROTNS_LOCKS_ADDR A:0x401310
y.create.l HWIO_BIMC_BRIC_GLOBAL2_COMPONENT_INFO_ADDR A:0x402000
y.create.l HWIO_BIMC_BRIC_DEFAULT_SEGMENT_ADDR A:0x4021f0
y.create.l HWIO_BIMC_BRIC_SEGMENT0_ADDR_BASE_A_LOWER_ADDR A:0x402200
y.create.l HWIO_BIMC_BRIC_SEGMENT1_ADDR_BASE_A_LOWER_ADDR A:0x402280
y.create.l HWIO_BIMC_BRIC_SEGMENT2_ADDR_BASE_A_LOWER_ADDR A:0x402300
y.create.l HWIO_BIMC_BRIC_SEGMENT0_ADDR_BASE_A_UPPER_ADDR A:0x402204
y.create.l HWIO_BIMC_BRIC_SEGMENT1_ADDR_BASE_A_UPPER_ADDR A:0x402284
y.create.l HWIO_BIMC_BRIC_SEGMENT2_ADDR_BASE_A_UPPER_ADDR A:0x402304
y.create.l HWIO_BIMC_BRIC_SEGMENT0_ADDR_MASK_A_LOWER_ADDR A:0x402208
y.create.l HWIO_BIMC_BRIC_SEGMENT1_ADDR_MASK_A_LOWER_ADDR A:0x402288
y.create.l HWIO_BIMC_BRIC_SEGMENT2_ADDR_MASK_A_LOWER_ADDR A:0x402308
y.create.l HWIO_BIMC_BRIC_SEGMENT0_ADDR_MASK_A_UPPER_ADDR A:0x40220c
y.create.l HWIO_BIMC_BRIC_SEGMENT1_ADDR_MASK_A_UPPER_ADDR A:0x40228c
y.create.l HWIO_BIMC_BRIC_SEGMENT2_ADDR_MASK_A_UPPER_ADDR A:0x40230c
y.create.l HWIO_BIMC_BRIC_SEGMENT0_ADDR_BASE_B_LOWER_ADDR A:0x402210
y.create.l HWIO_BIMC_BRIC_SEGMENT1_ADDR_BASE_B_LOWER_ADDR A:0x402290
y.create.l HWIO_BIMC_BRIC_SEGMENT2_ADDR_BASE_B_LOWER_ADDR A:0x402310
y.create.l HWIO_BIMC_BRIC_SEGMENT0_ADDR_BASE_B_UPPER_ADDR A:0x402214
y.create.l HWIO_BIMC_BRIC_SEGMENT1_ADDR_BASE_B_UPPER_ADDR A:0x402294
y.create.l HWIO_BIMC_BRIC_SEGMENT2_ADDR_BASE_B_UPPER_ADDR A:0x402314
y.create.l HWIO_BIMC_BRIC_SEGMENT0_ADDR_MASK_B_LOWER_ADDR A:0x402218
y.create.l HWIO_BIMC_BRIC_SEGMENT1_ADDR_MASK_B_LOWER_ADDR A:0x402298
y.create.l HWIO_BIMC_BRIC_SEGMENT2_ADDR_MASK_B_LOWER_ADDR A:0x402318
y.create.l HWIO_BIMC_BRIC_SEGMENT0_ADDR_MASK_B_UPPER_ADDR A:0x40221c
y.create.l HWIO_BIMC_BRIC_SEGMENT1_ADDR_MASK_B_UPPER_ADDR A:0x40229c
y.create.l HWIO_BIMC_BRIC_SEGMENT2_ADDR_MASK_B_UPPER_ADDR A:0x40231c
y.create.l HWIO_BIMC_BRIC_SEGMENT0_ADDR_BASE_C_LOWER_ADDR A:0x402220
y.create.l HWIO_BIMC_BRIC_SEGMENT1_ADDR_BASE_C_LOWER_ADDR A:0x4022a0
y.create.l HWIO_BIMC_BRIC_SEGMENT2_ADDR_BASE_C_LOWER_ADDR A:0x402320
y.create.l HWIO_BIMC_BRIC_SEGMENT0_ADDR_BASE_C_UPPER_ADDR A:0x402224
y.create.l HWIO_BIMC_BRIC_SEGMENT1_ADDR_BASE_C_UPPER_ADDR A:0x4022a4
y.create.l HWIO_BIMC_BRIC_SEGMENT2_ADDR_BASE_C_UPPER_ADDR A:0x402324
y.create.l HWIO_BIMC_BRIC_SEGMENT0_ADDR_MASK_C_LOWER_ADDR A:0x402228
y.create.l HWIO_BIMC_BRIC_SEGMENT1_ADDR_MASK_C_LOWER_ADDR A:0x4022a8
y.create.l HWIO_BIMC_BRIC_SEGMENT2_ADDR_MASK_C_LOWER_ADDR A:0x402328
y.create.l HWIO_BIMC_BRIC_SEGMENT0_ADDR_MASK_C_UPPER_ADDR A:0x40222c
y.create.l HWIO_BIMC_BRIC_SEGMENT1_ADDR_MASK_C_UPPER_ADDR A:0x4022ac
y.create.l HWIO_BIMC_BRIC_SEGMENT2_ADDR_MASK_C_UPPER_ADDR A:0x40232c
y.create.l HWIO_BIMC_BRIC_REMAP0_ADDR_BASE_LOWER_ADDR A:0x402a00
y.create.l HWIO_BIMC_BRIC_REMAP1_ADDR_BASE_LOWER_ADDR A:0x402a40
y.create.l HWIO_BIMC_BRIC_REMAP2_ADDR_BASE_LOWER_ADDR A:0x402a80
y.create.l HWIO_BIMC_BRIC_REMAP3_ADDR_BASE_LOWER_ADDR A:0x402ac0
y.create.l HWIO_BIMC_BRIC_REMAP0_ADDR_BASE_UPPER_ADDR A:0x402a04
y.create.l HWIO_BIMC_BRIC_REMAP1_ADDR_BASE_UPPER_ADDR A:0x402a44
y.create.l HWIO_BIMC_BRIC_REMAP2_ADDR_BASE_UPPER_ADDR A:0x402a84
y.create.l HWIO_BIMC_BRIC_REMAP3_ADDR_BASE_UPPER_ADDR A:0x402ac4
y.create.l HWIO_BIMC_BRIC_REMAP0_ADDR_MASK_LOWER_ADDR A:0x402a08
y.create.l HWIO_BIMC_BRIC_REMAP1_ADDR_MASK_LOWER_ADDR A:0x402a48
y.create.l HWIO_BIMC_BRIC_REMAP2_ADDR_MASK_LOWER_ADDR A:0x402a88
y.create.l HWIO_BIMC_BRIC_REMAP3_ADDR_MASK_LOWER_ADDR A:0x402ac8
y.create.l HWIO_BIMC_BRIC_REMAP0_ADDR_MASK_UPPER_ADDR A:0x402a0c
y.create.l HWIO_BIMC_BRIC_REMAP1_ADDR_MASK_UPPER_ADDR A:0x402a4c
y.create.l HWIO_BIMC_BRIC_REMAP2_ADDR_MASK_UPPER_ADDR A:0x402a8c
y.create.l HWIO_BIMC_BRIC_REMAP3_ADDR_MASK_UPPER_ADDR A:0x402acc
y.create.l HWIO_BIMC_BRIC_REMAP0_OP0_ADDR A:0x402a20
y.create.l HWIO_BIMC_BRIC_REMAP1_OP0_ADDR A:0x402a60
y.create.l HWIO_BIMC_BRIC_REMAP2_OP0_ADDR A:0x402aa0
y.create.l HWIO_BIMC_BRIC_REMAP3_OP0_ADDR A:0x402ae0
y.create.l HWIO_BIMC_BRIC_REMAP0_OP1_ADDR A:0x402a24
y.create.l HWIO_BIMC_BRIC_REMAP1_OP1_ADDR A:0x402a64
y.create.l HWIO_BIMC_BRIC_REMAP2_OP1_ADDR A:0x402aa4
y.create.l HWIO_BIMC_BRIC_REMAP3_OP1_ADDR A:0x402ae4
y.create.l HWIO_BIMC_PERFMON_COMPONENT_INFO_ADDR A:0x403000
y.create.l HWIO_BIMC_PERFMON_CONFIGURATION_INFO_ADDR A:0x403020
y.create.l HWIO_BIMC_PERFMON_CLOCK_CTRL_ADDR A:0x403200
y.create.l HWIO_BIMC_PERFMON_MODE_ADDR A:0x403210
y.create.l HWIO_BIMC_PERFMON_DUMP_ADDR A:0x403214
y.create.l HWIO_BIMC_PERFMON_TIMED_MODE_INTERVAL_ADDR A:0x403220
y.create.l HWIO_BIMC_PERFMON_TIMED_MODE_ITERATIONS_ADDR A:0x403230
y.create.l HWIO_BIMC_PERFMON_STATUS_ADDR A:0x4032f0
y.create.l HWIO_BIMC_PERFMON_COUNTER_0_CONFIG_ADDR A:0x403300
y.create.l HWIO_BIMC_PERFMON_COUNTER_1_CONFIG_ADDR A:0x403310
y.create.l HWIO_BIMC_PERFMON_COUNTER_2_CONFIG_ADDR A:0x403320
y.create.l HWIO_BIMC_PERFMON_COUNTER_3_CONFIG_ADDR A:0x403330
y.create.l HWIO_BIMC_PERFMON_COUNTER_4_CONFIG_ADDR A:0x403340
y.create.l HWIO_BIMC_PERFMON_COUNTER_5_CONFIG_ADDR A:0x403350
y.create.l HWIO_BIMC_PERFMON_COUNTER_6_CONFIG_ADDR A:0x403360
y.create.l HWIO_BIMC_PERFMON_COUNTER_7_CONFIG_ADDR A:0x403370
y.create.l HWIO_BIMC_PERFMON_COUNTER_8_CONFIG_ADDR A:0x403380
y.create.l HWIO_BIMC_PERFMON_COUNTER_9_CONFIG_ADDR A:0x403390
y.create.l HWIO_BIMC_PERFMON_COUNTER_0_ADDR A:0x403308
y.create.l HWIO_BIMC_PERFMON_COUNTER_1_ADDR A:0x403318
y.create.l HWIO_BIMC_PERFMON_COUNTER_2_ADDR A:0x403328
y.create.l HWIO_BIMC_PERFMON_COUNTER_3_ADDR A:0x403338
y.create.l HWIO_BIMC_PERFMON_COUNTER_4_ADDR A:0x403348
y.create.l HWIO_BIMC_PERFMON_COUNTER_5_ADDR A:0x403358
y.create.l HWIO_BIMC_PERFMON_COUNTER_6_ADDR A:0x403368
y.create.l HWIO_BIMC_PERFMON_COUNTER_7_ADDR A:0x403378
y.create.l HWIO_BIMC_PERFMON_COUNTER_8_ADDR A:0x403388
y.create.l HWIO_BIMC_PERFMON_COUNTER_9_ADDR A:0x403398
y.create.l HWIO_BIMC_PERFMON_COUNTER_0_OVERFLOW_ADDR A:0x40330c
y.create.l HWIO_BIMC_PERFMON_COUNTER_1_OVERFLOW_ADDR A:0x40331c
y.create.l HWIO_BIMC_PERFMON_COUNTER_2_OVERFLOW_ADDR A:0x40332c
y.create.l HWIO_BIMC_PERFMON_COUNTER_3_OVERFLOW_ADDR A:0x40333c
y.create.l HWIO_BIMC_PERFMON_COUNTER_4_OVERFLOW_ADDR A:0x40334c
y.create.l HWIO_BIMC_PERFMON_COUNTER_5_OVERFLOW_ADDR A:0x40335c
y.create.l HWIO_BIMC_PERFMON_COUNTER_6_OVERFLOW_ADDR A:0x40336c
y.create.l HWIO_BIMC_PERFMON_COUNTER_7_OVERFLOW_ADDR A:0x40337c
y.create.l HWIO_BIMC_PERFMON_COUNTER_8_OVERFLOW_ADDR A:0x40338c
y.create.l HWIO_BIMC_PERFMON_COUNTER_9_OVERFLOW_ADDR A:0x40339c
y.create.l HWIO_BIMC_DTE_HW_INFO_ADDR A:0x406000
y.create.l HWIO_BIMC_DTE_GLOBAL_CNTL_ADDR A:0x406004
y.create.l HWIO_BIMC_DTE_PROGRAM_CNTL_ADDR A:0x40600c
y.create.l HWIO_BIMC_DTE_REG_CNTL_ADDR A:0x406010
y.create.l HWIO_BIMC_DTE_REG_DATA_ADDR A:0x406014
y.create.l HWIO_BIMC_DTE_TEST_STATUS_DDR_ADDR A:0x406020
y.create.l HWIO_BIMC_DTE_TEST_STATUS_QSB_ADDR A:0x406024
y.create.l HWIO_BIMC_DTE_TEST_MEM_CNTL_ADDR A:0x406030
y.create.l HWIO_BIMC_DTE_TEST_MEM_DATA_0_ADDR A:0x406038
y.create.l HWIO_BIMC_DTE_TEST_MEM_DATA_1_ADDR A:0x40603c
y.create.l HWIO_BIMC_M_APP_MPORT_COMPONENT_INFO_ADDR A:0x408000
y.create.l HWIO_BIMC_M_APP_MPORT_CONFIGURATION_INFO_0_ADDR A:0x408020
y.create.l HWIO_BIMC_M_APP_MPORT_CONFIGURATION_INFO_1_ADDR A:0x408030
y.create.l HWIO_BIMC_M_APP_MPORT_CONFIGURATION_INFO_2A_ADDR A:0x408040
y.create.l HWIO_BIMC_M_APP_MPORT_CONFIGURATION_INFO_2B_ADDR A:0x408044
y.create.l HWIO_BIMC_M_APP_MPORT_CONFIGURATION_INFO_3_ADDR A:0x408050
y.create.l HWIO_BIMC_M_APP_MPORT_CONFIGURATION_INFO_4_ADDR A:0x408060
y.create.l HWIO_BIMC_M_APP_MPORT_CONFIGURATION_INFO_5A_ADDR A:0x408070
y.create.l HWIO_BIMC_M_APP_MPORT_CONFIGURATION_INFO_5B_ADDR A:0x408074
y.create.l HWIO_BIMC_M_APP_MPORT_CONFIGURATION_INFO_5C_ADDR A:0x408078
y.create.l HWIO_BIMC_M_APP_MPORT_CONFIGURATION_INFO_5D_ADDR A:0x40807c
y.create.l HWIO_BIMC_M_APP_MPORT_INTERRUPT_STATUS_ADDR A:0x408100
y.create.l HWIO_BIMC_M_APP_MPORT_INTERRUPT_CLEAR_ADDR A:0x408108
y.create.l HWIO_BIMC_M_APP_MPORT_INTERRUPT_ENABLE_ADDR A:0x40810c
y.create.l HWIO_BIMC_M_APP_MPORT_CLOCK_CTRL_ADDR A:0x408200
y.create.l HWIO_BIMC_M_APP_MPORT_CDC_CTRL_ADDR A:0x408208
y.create.l HWIO_BIMC_M_APP_MPORT_MODE_ADDR A:0x408210
y.create.l HWIO_BIMC_M_APP_MPORT_WR_WAY_CROSSING_ADDR A:0x408220
y.create.l HWIO_BIMC_M_APP_MPORT_PRIORITYLVL_OVERRIDE_ADDR A:0x408230
y.create.l HWIO_BIMC_M_APP_MPORT_READ_COMMAND_OVERRIDE_ADDR A:0x408240
y.create.l HWIO_BIMC_M_APP_MPORT_WRITE_COMMAND_OVERRIDE_ADDR A:0x408250
y.create.l HWIO_BIMC_M_APP_MPORT_RD_TRACKING_INDEX_ADDR A:0x408270
y.create.l HWIO_BIMC_M_APP_MPORT_WR_TRACKING_INDEX_ADDR A:0x408274
y.create.l HWIO_BIMC_M_APP_MPORT_BWMON_ENABLE_ADDR A:0x408280
y.create.l HWIO_BIMC_M_APP_MPORT_BWMON_CLEAR_ADDR A:0x408284
y.create.l HWIO_BIMC_M_APP_MPORT_BWMON_BYTE_COUNT_ADDR A:0x408288
y.create.l HWIO_BIMC_M_APP_MPORT_BWMON_THRESHOLD_ADDR A:0x408290
y.create.l HWIO_BIMC_M_APP_MPORT_BWMON_MID_MASK_ADDR A:0x408298
y.create.l HWIO_BIMC_M_APP_MPORT_BWMON_MID_MATCH_ADDR A:0x40829c
y.create.l HWIO_BIMC_M_APP_MPORT_BKE_ENABLE_ADDR A:0x408300
y.create.l HWIO_BIMC_M_APP_MPORT_BKE_GRANT_PERIOD_ADDR A:0x408304
y.create.l HWIO_BIMC_M_APP_MPORT_BKE_GRANT_COUNT_ADDR A:0x408308
y.create.l HWIO_BIMC_M_APP_MPORT_BKE_THRESHOLD_HIGH_ADDR A:0x408320
y.create.l HWIO_BIMC_M_APP_MPORT_BKE_THRESHOLD_MEDIUM_ADDR A:0x408324
y.create.l HWIO_BIMC_M_APP_MPORT_BKE_THRESHOLD_LOW_ADDR A:0x408328
y.create.l HWIO_BIMC_M_APP_MPORT_BKE_HEALTH_0_ADDR A:0x408340
y.create.l HWIO_BIMC_M_APP_MPORT_BKE_HEALTH_1_ADDR A:0x408344
y.create.l HWIO_BIMC_M_APP_MPORT_BKE_HEALTH_2_ADDR A:0x408348
y.create.l HWIO_BIMC_M_APP_MPORT_BKE_HEALTH_3_ADDR A:0x40834c
y.create.l HWIO_BIMC_M_APP_MPORT_STATUS_2A_ADDR A:0x408420
y.create.l HWIO_BIMC_M_APP_MPORT_STATUS_2B_ADDR A:0x408424
y.create.l HWIO_BIMC_M_APP_MPORT_STATUS_3A_ADDR A:0x408430
y.create.l HWIO_BIMC_M_APP_MPORT_STATUS_3B_ADDR A:0x408434
y.create.l HWIO_BIMC_M_APP_MPORT_BKE1_ENABLE_ADDR A:0x408800
y.create.l HWIO_BIMC_M_APP_MPORT_BKE1_GRANT_PERIOD_ADDR A:0x408804
y.create.l HWIO_BIMC_M_APP_MPORT_BKE1_GRANT_COUNT_ADDR A:0x408808
y.create.l HWIO_BIMC_M_APP_MPORT_BKE1_THRESHOLD_HIGH_ADDR A:0x408820
y.create.l HWIO_BIMC_M_APP_MPORT_BKE1_THRESHOLD_MEDIUM_ADDR A:0x408824
y.create.l HWIO_BIMC_M_APP_MPORT_BKE1_THRESHOLD_LOW_ADDR A:0x408828
y.create.l HWIO_BIMC_M_APP_MPORT_BKE1_HEALTH_0_ADDR A:0x408840
y.create.l HWIO_BIMC_M_APP_MPORT_BKE1_HEALTH_1_ADDR A:0x408844
y.create.l HWIO_BIMC_M_APP_MPORT_BKE1_HEALTH_2_ADDR A:0x408848
y.create.l HWIO_BIMC_M_APP_MPORT_BKE1_HEALTH_3_ADDR A:0x40884c
y.create.l HWIO_BIMC_M_APP_MPORT_BKE2_ENABLE_ADDR A:0x408900
y.create.l HWIO_BIMC_M_APP_MPORT_BKE2_GRANT_PERIOD_ADDR A:0x408904
y.create.l HWIO_BIMC_M_APP_MPORT_BKE2_GRANT_COUNT_ADDR A:0x408908
y.create.l HWIO_BIMC_M_APP_MPORT_BKE2_THRESHOLD_HIGH_ADDR A:0x408920
y.create.l HWIO_BIMC_M_APP_MPORT_BKE2_THRESHOLD_MEDIUM_ADDR A:0x408924
y.create.l HWIO_BIMC_M_APP_MPORT_BKE2_THRESHOLD_LOW_ADDR A:0x408928
y.create.l HWIO_BIMC_M_APP_MPORT_BKE2_HEALTH_0_ADDR A:0x408940
y.create.l HWIO_BIMC_M_APP_MPORT_BKE2_HEALTH_1_ADDR A:0x408944
y.create.l HWIO_BIMC_M_APP_MPORT_BKE2_HEALTH_2_ADDR A:0x408948
y.create.l HWIO_BIMC_M_APP_MPORT_BKE2_HEALTH_3_ADDR A:0x40894c
y.create.l HWIO_BIMC_M_APP_MPORT_BKE3_ENABLE_ADDR A:0x408a00
y.create.l HWIO_BIMC_M_APP_MPORT_BKE3_GRANT_PERIOD_ADDR A:0x408a04
y.create.l HWIO_BIMC_M_APP_MPORT_BKE3_GRANT_COUNT_ADDR A:0x408a08
y.create.l HWIO_BIMC_M_APP_MPORT_BKE3_THRESHOLD_HIGH_ADDR A:0x408a20
y.create.l HWIO_BIMC_M_APP_MPORT_BKE3_THRESHOLD_MEDIUM_ADDR A:0x408a24
y.create.l HWIO_BIMC_M_APP_MPORT_BKE3_THRESHOLD_LOW_ADDR A:0x408a28
y.create.l HWIO_BIMC_M_APP_MPORT_BKE3_HEALTH_0_ADDR A:0x408a40
y.create.l HWIO_BIMC_M_APP_MPORT_BKE3_HEALTH_1_ADDR A:0x408a44
y.create.l HWIO_BIMC_M_APP_MPORT_BKE3_HEALTH_2_ADDR A:0x408a48
y.create.l HWIO_BIMC_M_APP_MPORT_BKE3_HEALTH_3_ADDR A:0x408a4c
y.create.l HWIO_BIMC_M_APP_PROF_COMPONENT_INFO_ADDR A:0x409000
y.create.l HWIO_BIMC_M_APP_PROF_CONFIGURATION_INFO_0_ADDR A:0x409020
y.create.l HWIO_BIMC_M_APP_PROF_CONFIGURATION_INFO_1_ADDR A:0x409030
y.create.l HWIO_BIMC_M_APP_PROF_CLOCK_CTRL_ADDR A:0x409200
y.create.l HWIO_BIMC_M_APP_PROF_MODE_ADDR A:0x409210
y.create.l HWIO_BIMC_M_APP_PROF_RD_TENURE_THRESHOLD_ADDR A:0x409214
y.create.l HWIO_BIMC_M_APP_PROF_WR_TENURE_THRESHOLD_ADDR A:0x409218
y.create.l HWIO_BIMC_M_APP_PROF_SWAY_SELECT_ADDR A:0x409220
y.create.l HWIO_BIMC_M_APP_PROF_MID_MASK_ADDR A:0x409230
y.create.l HWIO_BIMC_M_APP_PROF_MID_MATCH_ADDR A:0x409234
y.create.l HWIO_BIMC_M_APP_PROF_MID_INV_MATCH_ADDR A:0x409238
y.create.l HWIO_BIMC_M_APP_PROF_ADDR_MASK_LOWER_ADDR A:0x409240
y.create.l HWIO_BIMC_M_APP_PROF_ADDR_MASK_UPPER_ADDR A:0x409244
y.create.l HWIO_BIMC_M_APP_PROF_ADDR_MATCH_LOWER_ADDR A:0x409248
y.create.l HWIO_BIMC_M_APP_PROF_ADDR_MATCH_UPPER_ADDR A:0x40924c
y.create.l HWIO_BIMC_M_APP_PROF_ADDR_INV_MATCH_ADDR A:0x409250
y.create.l HWIO_BIMC_M_APP_PROF_ACH_MASK_0_ADDR A:0x409260
y.create.l HWIO_BIMC_M_APP_PROF_ACH_MATCH_0_ADDR A:0x409264
y.create.l HWIO_BIMC_M_APP_PROF_ACH_MASK_1_ADDR A:0x409270
y.create.l HWIO_BIMC_M_APP_PROF_ACH_MATCH_1_ADDR A:0x409274
y.create.l HWIO_BIMC_M_APP_PROF_ACH_INV_MATCH_1_ADDR A:0x409278
y.create.l HWIO_BIMC_M_APP_PROF_ACH_MASK_2_ADDR A:0x409280
y.create.l HWIO_BIMC_M_APP_PROF_ACH_MATCH_2_ADDR A:0x409284
y.create.l HWIO_BIMC_M_APP_PROF_ACH_MASK_3_ADDR A:0x409290
y.create.l HWIO_BIMC_M_APP_PROF_ACH_MATCH_3_ADDR A:0x409294
y.create.l HWIO_BIMC_M_APP_PROF_ACH_INV_MATCH_3_ADDR A:0x409298
y.create.l HWIO_BIMC_M_APP_PROF_ACH_MASK_4_ADDR A:0x4092a0
y.create.l HWIO_BIMC_M_APP_PROF_ACH_MATCH_4_ADDR A:0x4092a4
y.create.l HWIO_BIMC_M_APP_PROF_ACH_INV_MATCH_4_ADDR A:0x4092a8
y.create.l HWIO_BIMC_M_APP_PROF_BCH_MASK_ADDR A:0x409300
y.create.l HWIO_BIMC_M_APP_PROF_BCH_MATCH_ADDR A:0x409304
y.create.l HWIO_BIMC_M_APP_PROF_BCH_INV_MATCH_ADDR A:0x409308
y.create.l HWIO_BIMC_M_APP_PROF_RCH_MASK_ADDR A:0x409340
y.create.l HWIO_BIMC_M_APP_PROF_RCH_MATCH_ADDR A:0x409344
y.create.l HWIO_BIMC_M_APP_PROF_RCH_INV_MATCH_ADDR A:0x409348
y.create.l HWIO_BIMC_M_APP_PROF_RD_STATUS_0_ADDR A:0x409400
y.create.l HWIO_BIMC_M_APP_PROF_WR_STATUS_0_ADDR A:0x409410
y.create.l HWIO_BIMC_M_DSP_MPORT_COMPONENT_INFO_ADDR A:0x40c000
y.create.l HWIO_BIMC_M_DSP_MPORT_CONFIGURATION_INFO_0_ADDR A:0x40c020
y.create.l HWIO_BIMC_M_DSP_MPORT_CONFIGURATION_INFO_1_ADDR A:0x40c030
y.create.l HWIO_BIMC_M_DSP_MPORT_CONFIGURATION_INFO_2A_ADDR A:0x40c040
y.create.l HWIO_BIMC_M_DSP_MPORT_CONFIGURATION_INFO_2B_ADDR A:0x40c044
y.create.l HWIO_BIMC_M_DSP_MPORT_CONFIGURATION_INFO_3_ADDR A:0x40c050
y.create.l HWIO_BIMC_M_DSP_MPORT_CONFIGURATION_INFO_4_ADDR A:0x40c060
y.create.l HWIO_BIMC_M_DSP_MPORT_CONFIGURATION_INFO_5A_ADDR A:0x40c070
y.create.l HWIO_BIMC_M_DSP_MPORT_CONFIGURATION_INFO_5B_ADDR A:0x40c074
y.create.l HWIO_BIMC_M_DSP_MPORT_CONFIGURATION_INFO_5C_ADDR A:0x40c078
y.create.l HWIO_BIMC_M_DSP_MPORT_CONFIGURATION_INFO_5D_ADDR A:0x40c07c
y.create.l HWIO_BIMC_M_DSP_MPORT_INTERRUPT_STATUS_ADDR A:0x40c100
y.create.l HWIO_BIMC_M_DSP_MPORT_INTERRUPT_CLEAR_ADDR A:0x40c108
y.create.l HWIO_BIMC_M_DSP_MPORT_INTERRUPT_ENABLE_ADDR A:0x40c10c
y.create.l HWIO_BIMC_M_DSP_MPORT_CLOCK_CTRL_ADDR A:0x40c200
y.create.l HWIO_BIMC_M_DSP_MPORT_CDC_CTRL_ADDR A:0x40c208
y.create.l HWIO_BIMC_M_DSP_MPORT_MODE_ADDR A:0x40c210
y.create.l HWIO_BIMC_M_DSP_MPORT_WR_WAY_CROSSING_ADDR A:0x40c220
y.create.l HWIO_BIMC_M_DSP_MPORT_PRIORITYLVL_OVERRIDE_ADDR A:0x40c230
y.create.l HWIO_BIMC_M_DSP_MPORT_READ_COMMAND_OVERRIDE_ADDR A:0x40c240
y.create.l HWIO_BIMC_M_DSP_MPORT_WRITE_COMMAND_OVERRIDE_ADDR A:0x40c250
y.create.l HWIO_BIMC_M_DSP_MPORT_RD_TRACKING_INDEX_ADDR A:0x40c270
y.create.l HWIO_BIMC_M_DSP_MPORT_WR_TRACKING_INDEX_ADDR A:0x40c274
y.create.l HWIO_BIMC_M_DSP_MPORT_BWMON_ENABLE_ADDR A:0x40c280
y.create.l HWIO_BIMC_M_DSP_MPORT_BWMON_CLEAR_ADDR A:0x40c284
y.create.l HWIO_BIMC_M_DSP_MPORT_BWMON_BYTE_COUNT_ADDR A:0x40c288
y.create.l HWIO_BIMC_M_DSP_MPORT_BWMON_THRESHOLD_ADDR A:0x40c290
y.create.l HWIO_BIMC_M_DSP_MPORT_BWMON_MID_MASK_ADDR A:0x40c298
y.create.l HWIO_BIMC_M_DSP_MPORT_BWMON_MID_MATCH_ADDR A:0x40c29c
y.create.l HWIO_BIMC_M_DSP_MPORT_BKE_ENABLE_ADDR A:0x40c300
y.create.l HWIO_BIMC_M_DSP_MPORT_BKE_GRANT_PERIOD_ADDR A:0x40c304
y.create.l HWIO_BIMC_M_DSP_MPORT_BKE_GRANT_COUNT_ADDR A:0x40c308
y.create.l HWIO_BIMC_M_DSP_MPORT_BKE_THRESHOLD_HIGH_ADDR A:0x40c320
y.create.l HWIO_BIMC_M_DSP_MPORT_BKE_THRESHOLD_MEDIUM_ADDR A:0x40c324
y.create.l HWIO_BIMC_M_DSP_MPORT_BKE_THRESHOLD_LOW_ADDR A:0x40c328
y.create.l HWIO_BIMC_M_DSP_MPORT_BKE_HEALTH_0_ADDR A:0x40c340
y.create.l HWIO_BIMC_M_DSP_MPORT_BKE_HEALTH_1_ADDR A:0x40c344
y.create.l HWIO_BIMC_M_DSP_MPORT_BKE_HEALTH_2_ADDR A:0x40c348
y.create.l HWIO_BIMC_M_DSP_MPORT_BKE_HEALTH_3_ADDR A:0x40c34c
y.create.l HWIO_BIMC_M_DSP_MPORT_STATUS_2A_ADDR A:0x40c420
y.create.l HWIO_BIMC_M_DSP_MPORT_STATUS_2B_ADDR A:0x40c424
y.create.l HWIO_BIMC_M_DSP_MPORT_STATUS_3A_ADDR A:0x40c430
y.create.l HWIO_BIMC_M_DSP_MPORT_STATUS_3B_ADDR A:0x40c434
y.create.l HWIO_BIMC_M_DSP_MPORT_BKE1_ENABLE_ADDR A:0x40c800
y.create.l HWIO_BIMC_M_DSP_MPORT_BKE1_GRANT_PERIOD_ADDR A:0x40c804
y.create.l HWIO_BIMC_M_DSP_MPORT_BKE1_GRANT_COUNT_ADDR A:0x40c808
y.create.l HWIO_BIMC_M_DSP_MPORT_BKE1_THRESHOLD_HIGH_ADDR A:0x40c820
y.create.l HWIO_BIMC_M_DSP_MPORT_BKE1_THRESHOLD_MEDIUM_ADDR A:0x40c824
y.create.l HWIO_BIMC_M_DSP_MPORT_BKE1_THRESHOLD_LOW_ADDR A:0x40c828
y.create.l HWIO_BIMC_M_DSP_MPORT_BKE1_HEALTH_0_ADDR A:0x40c840
y.create.l HWIO_BIMC_M_DSP_MPORT_BKE1_HEALTH_1_ADDR A:0x40c844
y.create.l HWIO_BIMC_M_DSP_MPORT_BKE1_HEALTH_2_ADDR A:0x40c848
y.create.l HWIO_BIMC_M_DSP_MPORT_BKE1_HEALTH_3_ADDR A:0x40c84c
y.create.l HWIO_BIMC_M_DSP_MPORT_BKE2_ENABLE_ADDR A:0x40c900
y.create.l HWIO_BIMC_M_DSP_MPORT_BKE2_GRANT_PERIOD_ADDR A:0x40c904
y.create.l HWIO_BIMC_M_DSP_MPORT_BKE2_GRANT_COUNT_ADDR A:0x40c908
y.create.l HWIO_BIMC_M_DSP_MPORT_BKE2_THRESHOLD_HIGH_ADDR A:0x40c920
y.create.l HWIO_BIMC_M_DSP_MPORT_BKE2_THRESHOLD_MEDIUM_ADDR A:0x40c924
y.create.l HWIO_BIMC_M_DSP_MPORT_BKE2_THRESHOLD_LOW_ADDR A:0x40c928
y.create.l HWIO_BIMC_M_DSP_MPORT_BKE2_HEALTH_0_ADDR A:0x40c940
y.create.l HWIO_BIMC_M_DSP_MPORT_BKE2_HEALTH_1_ADDR A:0x40c944
y.create.l HWIO_BIMC_M_DSP_MPORT_BKE2_HEALTH_2_ADDR A:0x40c948
y.create.l HWIO_BIMC_M_DSP_MPORT_BKE2_HEALTH_3_ADDR A:0x40c94c
y.create.l HWIO_BIMC_M_DSP_MPORT_BKE3_ENABLE_ADDR A:0x40ca00
y.create.l HWIO_BIMC_M_DSP_MPORT_BKE3_GRANT_PERIOD_ADDR A:0x40ca04
y.create.l HWIO_BIMC_M_DSP_MPORT_BKE3_GRANT_COUNT_ADDR A:0x40ca08
y.create.l HWIO_BIMC_M_DSP_MPORT_BKE3_THRESHOLD_HIGH_ADDR A:0x40ca20
y.create.l HWIO_BIMC_M_DSP_MPORT_BKE3_THRESHOLD_MEDIUM_ADDR A:0x40ca24
y.create.l HWIO_BIMC_M_DSP_MPORT_BKE3_THRESHOLD_LOW_ADDR A:0x40ca28
y.create.l HWIO_BIMC_M_DSP_MPORT_BKE3_HEALTH_0_ADDR A:0x40ca40
y.create.l HWIO_BIMC_M_DSP_MPORT_BKE3_HEALTH_1_ADDR A:0x40ca44
y.create.l HWIO_BIMC_M_DSP_MPORT_BKE3_HEALTH_2_ADDR A:0x40ca48
y.create.l HWIO_BIMC_M_DSP_MPORT_BKE3_HEALTH_3_ADDR A:0x40ca4c
y.create.l HWIO_BIMC_M_DSP_PROF_COMPONENT_INFO_ADDR A:0x40d000
y.create.l HWIO_BIMC_M_DSP_PROF_CONFIGURATION_INFO_0_ADDR A:0x40d020
y.create.l HWIO_BIMC_M_DSP_PROF_CONFIGURATION_INFO_1_ADDR A:0x40d030
y.create.l HWIO_BIMC_M_DSP_PROF_CLOCK_CTRL_ADDR A:0x40d200
y.create.l HWIO_BIMC_M_DSP_PROF_MODE_ADDR A:0x40d210
y.create.l HWIO_BIMC_M_DSP_PROF_RD_TENURE_THRESHOLD_ADDR A:0x40d214
y.create.l HWIO_BIMC_M_DSP_PROF_WR_TENURE_THRESHOLD_ADDR A:0x40d218
y.create.l HWIO_BIMC_M_DSP_PROF_SWAY_SELECT_ADDR A:0x40d220
y.create.l HWIO_BIMC_M_DSP_PROF_MID_MASK_ADDR A:0x40d230
y.create.l HWIO_BIMC_M_DSP_PROF_MID_MATCH_ADDR A:0x40d234
y.create.l HWIO_BIMC_M_DSP_PROF_MID_INV_MATCH_ADDR A:0x40d238
y.create.l HWIO_BIMC_M_DSP_PROF_ADDR_MASK_LOWER_ADDR A:0x40d240
y.create.l HWIO_BIMC_M_DSP_PROF_ADDR_MASK_UPPER_ADDR A:0x40d244
y.create.l HWIO_BIMC_M_DSP_PROF_ADDR_MATCH_LOWER_ADDR A:0x40d248
y.create.l HWIO_BIMC_M_DSP_PROF_ADDR_MATCH_UPPER_ADDR A:0x40d24c
y.create.l HWIO_BIMC_M_DSP_PROF_ADDR_INV_MATCH_ADDR A:0x40d250
y.create.l HWIO_BIMC_M_DSP_PROF_ACH_MASK_0_ADDR A:0x40d260
y.create.l HWIO_BIMC_M_DSP_PROF_ACH_MATCH_0_ADDR A:0x40d264
y.create.l HWIO_BIMC_M_DSP_PROF_ACH_MASK_1_ADDR A:0x40d270
y.create.l HWIO_BIMC_M_DSP_PROF_ACH_MATCH_1_ADDR A:0x40d274
y.create.l HWIO_BIMC_M_DSP_PROF_ACH_INV_MATCH_1_ADDR A:0x40d278
y.create.l HWIO_BIMC_M_DSP_PROF_ACH_MASK_2_ADDR A:0x40d280
y.create.l HWIO_BIMC_M_DSP_PROF_ACH_MATCH_2_ADDR A:0x40d284
y.create.l HWIO_BIMC_M_DSP_PROF_ACH_MASK_3_ADDR A:0x40d290
y.create.l HWIO_BIMC_M_DSP_PROF_ACH_MATCH_3_ADDR A:0x40d294
y.create.l HWIO_BIMC_M_DSP_PROF_ACH_INV_MATCH_3_ADDR A:0x40d298
y.create.l HWIO_BIMC_M_DSP_PROF_ACH_MASK_4_ADDR A:0x40d2a0
y.create.l HWIO_BIMC_M_DSP_PROF_ACH_MATCH_4_ADDR A:0x40d2a4
y.create.l HWIO_BIMC_M_DSP_PROF_ACH_INV_MATCH_4_ADDR A:0x40d2a8
y.create.l HWIO_BIMC_M_DSP_PROF_BCH_MASK_ADDR A:0x40d300
y.create.l HWIO_BIMC_M_DSP_PROF_BCH_MATCH_ADDR A:0x40d304
y.create.l HWIO_BIMC_M_DSP_PROF_BCH_INV_MATCH_ADDR A:0x40d308
y.create.l HWIO_BIMC_M_DSP_PROF_RCH_MASK_ADDR A:0x40d340
y.create.l HWIO_BIMC_M_DSP_PROF_RCH_MATCH_ADDR A:0x40d344
y.create.l HWIO_BIMC_M_DSP_PROF_RCH_INV_MATCH_ADDR A:0x40d348
y.create.l HWIO_BIMC_M_DSP_PROF_RD_STATUS_0_ADDR A:0x40d400
y.create.l HWIO_BIMC_M_DSP_PROF_WR_STATUS_0_ADDR A:0x40d410
y.create.l HWIO_BIMC_M_GPU_MPORT_COMPONENT_INFO_ADDR A:0x410000
y.create.l HWIO_BIMC_M_GPU_MPORT_CONFIGURATION_INFO_0_ADDR A:0x410020
y.create.l HWIO_BIMC_M_GPU_MPORT_CONFIGURATION_INFO_1_ADDR A:0x410030
y.create.l HWIO_BIMC_M_GPU_MPORT_CONFIGURATION_INFO_2A_ADDR A:0x410040
y.create.l HWIO_BIMC_M_GPU_MPORT_CONFIGURATION_INFO_2B_ADDR A:0x410044
y.create.l HWIO_BIMC_M_GPU_MPORT_CONFIGURATION_INFO_3_ADDR A:0x410050
y.create.l HWIO_BIMC_M_GPU_MPORT_CONFIGURATION_INFO_4_ADDR A:0x410060
y.create.l HWIO_BIMC_M_GPU_MPORT_CONFIGURATION_INFO_5A_ADDR A:0x410070
y.create.l HWIO_BIMC_M_GPU_MPORT_CONFIGURATION_INFO_5B_ADDR A:0x410074
y.create.l HWIO_BIMC_M_GPU_MPORT_CONFIGURATION_INFO_5C_ADDR A:0x410078
y.create.l HWIO_BIMC_M_GPU_MPORT_CONFIGURATION_INFO_5D_ADDR A:0x41007c
y.create.l HWIO_BIMC_M_GPU_MPORT_INTERRUPT_STATUS_ADDR A:0x410100
y.create.l HWIO_BIMC_M_GPU_MPORT_INTERRUPT_CLEAR_ADDR A:0x410108
y.create.l HWIO_BIMC_M_GPU_MPORT_INTERRUPT_ENABLE_ADDR A:0x41010c
y.create.l HWIO_BIMC_M_GPU_MPORT_CLOCK_CTRL_ADDR A:0x410200
y.create.l HWIO_BIMC_M_GPU_MPORT_CDC_CTRL_ADDR A:0x410208
y.create.l HWIO_BIMC_M_GPU_MPORT_MODE_ADDR A:0x410210
y.create.l HWIO_BIMC_M_GPU_MPORT_WR_WAY_CROSSING_ADDR A:0x410220
y.create.l HWIO_BIMC_M_GPU_MPORT_PRIORITYLVL_OVERRIDE_ADDR A:0x410230
y.create.l HWIO_BIMC_M_GPU_MPORT_READ_COMMAND_OVERRIDE_ADDR A:0x410240
y.create.l HWIO_BIMC_M_GPU_MPORT_WRITE_COMMAND_OVERRIDE_ADDR A:0x410250
y.create.l HWIO_BIMC_M_GPU_MPORT_RD_TRACKING_INDEX_ADDR A:0x410270
y.create.l HWIO_BIMC_M_GPU_MPORT_WR_TRACKING_INDEX_ADDR A:0x410274
y.create.l HWIO_BIMC_M_GPU_MPORT_BWMON_ENABLE_ADDR A:0x410280
y.create.l HWIO_BIMC_M_GPU_MPORT_BWMON_CLEAR_ADDR A:0x410284
y.create.l HWIO_BIMC_M_GPU_MPORT_BWMON_BYTE_COUNT_ADDR A:0x410288
y.create.l HWIO_BIMC_M_GPU_MPORT_BWMON_THRESHOLD_ADDR A:0x410290
y.create.l HWIO_BIMC_M_GPU_MPORT_BWMON_MID_MASK_ADDR A:0x410298
y.create.l HWIO_BIMC_M_GPU_MPORT_BWMON_MID_MATCH_ADDR A:0x41029c
y.create.l HWIO_BIMC_M_GPU_MPORT_BKE_ENABLE_ADDR A:0x410300
y.create.l HWIO_BIMC_M_GPU_MPORT_BKE_GRANT_PERIOD_ADDR A:0x410304
y.create.l HWIO_BIMC_M_GPU_MPORT_BKE_GRANT_COUNT_ADDR A:0x410308
y.create.l HWIO_BIMC_M_GPU_MPORT_BKE_THRESHOLD_HIGH_ADDR A:0x410320
y.create.l HWIO_BIMC_M_GPU_MPORT_BKE_THRESHOLD_MEDIUM_ADDR A:0x410324
y.create.l HWIO_BIMC_M_GPU_MPORT_BKE_THRESHOLD_LOW_ADDR A:0x410328
y.create.l HWIO_BIMC_M_GPU_MPORT_BKE_HEALTH_0_ADDR A:0x410340
y.create.l HWIO_BIMC_M_GPU_MPORT_BKE_HEALTH_1_ADDR A:0x410344
y.create.l HWIO_BIMC_M_GPU_MPORT_BKE_HEALTH_2_ADDR A:0x410348
y.create.l HWIO_BIMC_M_GPU_MPORT_BKE_HEALTH_3_ADDR A:0x41034c
y.create.l HWIO_BIMC_M_GPU_MPORT_STATUS_2A_ADDR A:0x410420
y.create.l HWIO_BIMC_M_GPU_MPORT_STATUS_2B_ADDR A:0x410424
y.create.l HWIO_BIMC_M_GPU_MPORT_STATUS_3A_ADDR A:0x410430
y.create.l HWIO_BIMC_M_GPU_MPORT_STATUS_3B_ADDR A:0x410434
y.create.l HWIO_BIMC_M_GPU_MPORT_BKE1_ENABLE_ADDR A:0x410800
y.create.l HWIO_BIMC_M_GPU_MPORT_BKE1_GRANT_PERIOD_ADDR A:0x410804
y.create.l HWIO_BIMC_M_GPU_MPORT_BKE1_GRANT_COUNT_ADDR A:0x410808
y.create.l HWIO_BIMC_M_GPU_MPORT_BKE1_THRESHOLD_HIGH_ADDR A:0x410820
y.create.l HWIO_BIMC_M_GPU_MPORT_BKE1_THRESHOLD_MEDIUM_ADDR A:0x410824
y.create.l HWIO_BIMC_M_GPU_MPORT_BKE1_THRESHOLD_LOW_ADDR A:0x410828
y.create.l HWIO_BIMC_M_GPU_MPORT_BKE1_HEALTH_0_ADDR A:0x410840
y.create.l HWIO_BIMC_M_GPU_MPORT_BKE1_HEALTH_1_ADDR A:0x410844
y.create.l HWIO_BIMC_M_GPU_MPORT_BKE1_HEALTH_2_ADDR A:0x410848
y.create.l HWIO_BIMC_M_GPU_MPORT_BKE1_HEALTH_3_ADDR A:0x41084c
y.create.l HWIO_BIMC_M_GPU_MPORT_BKE2_ENABLE_ADDR A:0x410900
y.create.l HWIO_BIMC_M_GPU_MPORT_BKE2_GRANT_PERIOD_ADDR A:0x410904
y.create.l HWIO_BIMC_M_GPU_MPORT_BKE2_GRANT_COUNT_ADDR A:0x410908
y.create.l HWIO_BIMC_M_GPU_MPORT_BKE2_THRESHOLD_HIGH_ADDR A:0x410920
y.create.l HWIO_BIMC_M_GPU_MPORT_BKE2_THRESHOLD_MEDIUM_ADDR A:0x410924
y.create.l HWIO_BIMC_M_GPU_MPORT_BKE2_THRESHOLD_LOW_ADDR A:0x410928
y.create.l HWIO_BIMC_M_GPU_MPORT_BKE2_HEALTH_0_ADDR A:0x410940
y.create.l HWIO_BIMC_M_GPU_MPORT_BKE2_HEALTH_1_ADDR A:0x410944
y.create.l HWIO_BIMC_M_GPU_MPORT_BKE2_HEALTH_2_ADDR A:0x410948
y.create.l HWIO_BIMC_M_GPU_MPORT_BKE2_HEALTH_3_ADDR A:0x41094c
y.create.l HWIO_BIMC_M_GPU_MPORT_BKE3_ENABLE_ADDR A:0x410a00
y.create.l HWIO_BIMC_M_GPU_MPORT_BKE3_GRANT_PERIOD_ADDR A:0x410a04
y.create.l HWIO_BIMC_M_GPU_MPORT_BKE3_GRANT_COUNT_ADDR A:0x410a08
y.create.l HWIO_BIMC_M_GPU_MPORT_BKE3_THRESHOLD_HIGH_ADDR A:0x410a20
y.create.l HWIO_BIMC_M_GPU_MPORT_BKE3_THRESHOLD_MEDIUM_ADDR A:0x410a24
y.create.l HWIO_BIMC_M_GPU_MPORT_BKE3_THRESHOLD_LOW_ADDR A:0x410a28
y.create.l HWIO_BIMC_M_GPU_MPORT_BKE3_HEALTH_0_ADDR A:0x410a40
y.create.l HWIO_BIMC_M_GPU_MPORT_BKE3_HEALTH_1_ADDR A:0x410a44
y.create.l HWIO_BIMC_M_GPU_MPORT_BKE3_HEALTH_2_ADDR A:0x410a48
y.create.l HWIO_BIMC_M_GPU_MPORT_BKE3_HEALTH_3_ADDR A:0x410a4c
y.create.l HWIO_BIMC_M_GPU_PROF_COMPONENT_INFO_ADDR A:0x411000
y.create.l HWIO_BIMC_M_GPU_PROF_CONFIGURATION_INFO_0_ADDR A:0x411020
y.create.l HWIO_BIMC_M_GPU_PROF_CONFIGURATION_INFO_1_ADDR A:0x411030
y.create.l HWIO_BIMC_M_GPU_PROF_CLOCK_CTRL_ADDR A:0x411200
y.create.l HWIO_BIMC_M_GPU_PROF_MODE_ADDR A:0x411210
y.create.l HWIO_BIMC_M_GPU_PROF_RD_TENURE_THRESHOLD_ADDR A:0x411214
y.create.l HWIO_BIMC_M_GPU_PROF_WR_TENURE_THRESHOLD_ADDR A:0x411218
y.create.l HWIO_BIMC_M_GPU_PROF_SWAY_SELECT_ADDR A:0x411220
y.create.l HWIO_BIMC_M_GPU_PROF_MID_MASK_ADDR A:0x411230
y.create.l HWIO_BIMC_M_GPU_PROF_MID_MATCH_ADDR A:0x411234
y.create.l HWIO_BIMC_M_GPU_PROF_MID_INV_MATCH_ADDR A:0x411238
y.create.l HWIO_BIMC_M_GPU_PROF_ADDR_MASK_LOWER_ADDR A:0x411240
y.create.l HWIO_BIMC_M_GPU_PROF_ADDR_MASK_UPPER_ADDR A:0x411244
y.create.l HWIO_BIMC_M_GPU_PROF_ADDR_MATCH_LOWER_ADDR A:0x411248
y.create.l HWIO_BIMC_M_GPU_PROF_ADDR_MATCH_UPPER_ADDR A:0x41124c
y.create.l HWIO_BIMC_M_GPU_PROF_ADDR_INV_MATCH_ADDR A:0x411250
y.create.l HWIO_BIMC_M_GPU_PROF_ACH_MASK_0_ADDR A:0x411260
y.create.l HWIO_BIMC_M_GPU_PROF_ACH_MATCH_0_ADDR A:0x411264
y.create.l HWIO_BIMC_M_GPU_PROF_ACH_MASK_1_ADDR A:0x411270
y.create.l HWIO_BIMC_M_GPU_PROF_ACH_MATCH_1_ADDR A:0x411274
y.create.l HWIO_BIMC_M_GPU_PROF_ACH_INV_MATCH_1_ADDR A:0x411278
y.create.l HWIO_BIMC_M_GPU_PROF_ACH_MASK_2_ADDR A:0x411280
y.create.l HWIO_BIMC_M_GPU_PROF_ACH_MATCH_2_ADDR A:0x411284
y.create.l HWIO_BIMC_M_GPU_PROF_ACH_MASK_3_ADDR A:0x411290
y.create.l HWIO_BIMC_M_GPU_PROF_ACH_MATCH_3_ADDR A:0x411294
y.create.l HWIO_BIMC_M_GPU_PROF_ACH_INV_MATCH_3_ADDR A:0x411298
y.create.l HWIO_BIMC_M_GPU_PROF_ACH_MASK_4_ADDR A:0x4112a0
y.create.l HWIO_BIMC_M_GPU_PROF_ACH_MATCH_4_ADDR A:0x4112a4
y.create.l HWIO_BIMC_M_GPU_PROF_ACH_INV_MATCH_4_ADDR A:0x4112a8
y.create.l HWIO_BIMC_M_GPU_PROF_BCH_MASK_ADDR A:0x411300
y.create.l HWIO_BIMC_M_GPU_PROF_BCH_MATCH_ADDR A:0x411304
y.create.l HWIO_BIMC_M_GPU_PROF_BCH_INV_MATCH_ADDR A:0x411308
y.create.l HWIO_BIMC_M_GPU_PROF_RCH_MASK_ADDR A:0x411340
y.create.l HWIO_BIMC_M_GPU_PROF_RCH_MATCH_ADDR A:0x411344
y.create.l HWIO_BIMC_M_GPU_PROF_RCH_INV_MATCH_ADDR A:0x411348
y.create.l HWIO_BIMC_M_GPU_PROF_RD_STATUS_0_ADDR A:0x411400
y.create.l HWIO_BIMC_M_GPU_PROF_WR_STATUS_0_ADDR A:0x411410
y.create.l HWIO_BIMC_M_SYS0_MPORT_COMPONENT_INFO_ADDR A:0x414000
y.create.l HWIO_BIMC_M_SYS0_MPORT_CONFIGURATION_INFO_0_ADDR A:0x414020
y.create.l HWIO_BIMC_M_SYS0_MPORT_CONFIGURATION_INFO_1_ADDR A:0x414030
y.create.l HWIO_BIMC_M_SYS0_MPORT_CONFIGURATION_INFO_2A_ADDR A:0x414040
y.create.l HWIO_BIMC_M_SYS0_MPORT_CONFIGURATION_INFO_2B_ADDR A:0x414044
y.create.l HWIO_BIMC_M_SYS0_MPORT_CONFIGURATION_INFO_3_ADDR A:0x414050
y.create.l HWIO_BIMC_M_SYS0_MPORT_CONFIGURATION_INFO_4_ADDR A:0x414060
y.create.l HWIO_BIMC_M_SYS0_MPORT_CONFIGURATION_INFO_5A_ADDR A:0x414070
y.create.l HWIO_BIMC_M_SYS0_MPORT_CONFIGURATION_INFO_5B_ADDR A:0x414074
y.create.l HWIO_BIMC_M_SYS0_MPORT_CONFIGURATION_INFO_5C_ADDR A:0x414078
y.create.l HWIO_BIMC_M_SYS0_MPORT_CONFIGURATION_INFO_5D_ADDR A:0x41407c
y.create.l HWIO_BIMC_M_SYS0_MPORT_INTERRUPT_STATUS_ADDR A:0x414100
y.create.l HWIO_BIMC_M_SYS0_MPORT_INTERRUPT_CLEAR_ADDR A:0x414108
y.create.l HWIO_BIMC_M_SYS0_MPORT_INTERRUPT_ENABLE_ADDR A:0x41410c
y.create.l HWIO_BIMC_M_SYS0_MPORT_CLOCK_CTRL_ADDR A:0x414200
y.create.l HWIO_BIMC_M_SYS0_MPORT_CDC_CTRL_ADDR A:0x414208
y.create.l HWIO_BIMC_M_SYS0_MPORT_MODE_ADDR A:0x414210
y.create.l HWIO_BIMC_M_SYS0_MPORT_WR_WAY_CROSSING_ADDR A:0x414220
y.create.l HWIO_BIMC_M_SYS0_MPORT_PRIORITYLVL_OVERRIDE_ADDR A:0x414230
y.create.l HWIO_BIMC_M_SYS0_MPORT_READ_COMMAND_OVERRIDE_ADDR A:0x414240
y.create.l HWIO_BIMC_M_SYS0_MPORT_WRITE_COMMAND_OVERRIDE_ADDR A:0x414250
y.create.l HWIO_BIMC_M_SYS0_MPORT_RD_TRACKING_INDEX_ADDR A:0x414270
y.create.l HWIO_BIMC_M_SYS0_MPORT_WR_TRACKING_INDEX_ADDR A:0x414274
y.create.l HWIO_BIMC_M_SYS0_MPORT_BWMON_ENABLE_ADDR A:0x414280
y.create.l HWIO_BIMC_M_SYS0_MPORT_BWMON_CLEAR_ADDR A:0x414284
y.create.l HWIO_BIMC_M_SYS0_MPORT_BWMON_BYTE_COUNT_ADDR A:0x414288
y.create.l HWIO_BIMC_M_SYS0_MPORT_BWMON_THRESHOLD_ADDR A:0x414290
y.create.l HWIO_BIMC_M_SYS0_MPORT_BWMON_MID_MASK_ADDR A:0x414298
y.create.l HWIO_BIMC_M_SYS0_MPORT_BWMON_MID_MATCH_ADDR A:0x41429c
y.create.l HWIO_BIMC_M_SYS0_MPORT_BKE_ENABLE_ADDR A:0x414300
y.create.l HWIO_BIMC_M_SYS0_MPORT_BKE_GRANT_PERIOD_ADDR A:0x414304
y.create.l HWIO_BIMC_M_SYS0_MPORT_BKE_GRANT_COUNT_ADDR A:0x414308
y.create.l HWIO_BIMC_M_SYS0_MPORT_BKE_THRESHOLD_HIGH_ADDR A:0x414320
y.create.l HWIO_BIMC_M_SYS0_MPORT_BKE_THRESHOLD_MEDIUM_ADDR A:0x414324
y.create.l HWIO_BIMC_M_SYS0_MPORT_BKE_THRESHOLD_LOW_ADDR A:0x414328
y.create.l HWIO_BIMC_M_SYS0_MPORT_BKE_HEALTH_0_ADDR A:0x414340
y.create.l HWIO_BIMC_M_SYS0_MPORT_BKE_HEALTH_1_ADDR A:0x414344
y.create.l HWIO_BIMC_M_SYS0_MPORT_BKE_HEALTH_2_ADDR A:0x414348
y.create.l HWIO_BIMC_M_SYS0_MPORT_BKE_HEALTH_3_ADDR A:0x41434c
y.create.l HWIO_BIMC_M_SYS0_MPORT_STATUS_2A_ADDR A:0x414420
y.create.l HWIO_BIMC_M_SYS0_MPORT_STATUS_2B_ADDR A:0x414424
y.create.l HWIO_BIMC_M_SYS0_MPORT_STATUS_3A_ADDR A:0x414430
y.create.l HWIO_BIMC_M_SYS0_MPORT_STATUS_3B_ADDR A:0x414434
y.create.l HWIO_BIMC_M_SYS0_MPORT_BKE1_ENABLE_ADDR A:0x414800
y.create.l HWIO_BIMC_M_SYS0_MPORT_BKE1_GRANT_PERIOD_ADDR A:0x414804
y.create.l HWIO_BIMC_M_SYS0_MPORT_BKE1_GRANT_COUNT_ADDR A:0x414808
y.create.l HWIO_BIMC_M_SYS0_MPORT_BKE1_THRESHOLD_HIGH_ADDR A:0x414820
y.create.l HWIO_BIMC_M_SYS0_MPORT_BKE1_THRESHOLD_MEDIUM_ADDR A:0x414824
y.create.l HWIO_BIMC_M_SYS0_MPORT_BKE1_THRESHOLD_LOW_ADDR A:0x414828
y.create.l HWIO_BIMC_M_SYS0_MPORT_BKE1_HEALTH_0_ADDR A:0x414840
y.create.l HWIO_BIMC_M_SYS0_MPORT_BKE1_HEALTH_1_ADDR A:0x414844
y.create.l HWIO_BIMC_M_SYS0_MPORT_BKE1_HEALTH_2_ADDR A:0x414848
y.create.l HWIO_BIMC_M_SYS0_MPORT_BKE1_HEALTH_3_ADDR A:0x41484c
y.create.l HWIO_BIMC_M_SYS0_MPORT_BKE2_ENABLE_ADDR A:0x414900
y.create.l HWIO_BIMC_M_SYS0_MPORT_BKE2_GRANT_PERIOD_ADDR A:0x414904
y.create.l HWIO_BIMC_M_SYS0_MPORT_BKE2_GRANT_COUNT_ADDR A:0x414908
y.create.l HWIO_BIMC_M_SYS0_MPORT_BKE2_THRESHOLD_HIGH_ADDR A:0x414920
y.create.l HWIO_BIMC_M_SYS0_MPORT_BKE2_THRESHOLD_MEDIUM_ADDR A:0x414924
y.create.l HWIO_BIMC_M_SYS0_MPORT_BKE2_THRESHOLD_LOW_ADDR A:0x414928
y.create.l HWIO_BIMC_M_SYS0_MPORT_BKE2_HEALTH_0_ADDR A:0x414940
y.create.l HWIO_BIMC_M_SYS0_MPORT_BKE2_HEALTH_1_ADDR A:0x414944
y.create.l HWIO_BIMC_M_SYS0_MPORT_BKE2_HEALTH_2_ADDR A:0x414948
y.create.l HWIO_BIMC_M_SYS0_MPORT_BKE2_HEALTH_3_ADDR A:0x41494c
y.create.l HWIO_BIMC_M_SYS0_MPORT_BKE3_ENABLE_ADDR A:0x414a00
y.create.l HWIO_BIMC_M_SYS0_MPORT_BKE3_GRANT_PERIOD_ADDR A:0x414a04
y.create.l HWIO_BIMC_M_SYS0_MPORT_BKE3_GRANT_COUNT_ADDR A:0x414a08
y.create.l HWIO_BIMC_M_SYS0_MPORT_BKE3_THRESHOLD_HIGH_ADDR A:0x414a20
y.create.l HWIO_BIMC_M_SYS0_MPORT_BKE3_THRESHOLD_MEDIUM_ADDR A:0x414a24
y.create.l HWIO_BIMC_M_SYS0_MPORT_BKE3_THRESHOLD_LOW_ADDR A:0x414a28
y.create.l HWIO_BIMC_M_SYS0_MPORT_BKE3_HEALTH_0_ADDR A:0x414a40
y.create.l HWIO_BIMC_M_SYS0_MPORT_BKE3_HEALTH_1_ADDR A:0x414a44
y.create.l HWIO_BIMC_M_SYS0_MPORT_BKE3_HEALTH_2_ADDR A:0x414a48
y.create.l HWIO_BIMC_M_SYS0_MPORT_BKE3_HEALTH_3_ADDR A:0x414a4c
y.create.l HWIO_BIMC_M_SYS0_PROF_COMPONENT_INFO_ADDR A:0x415000
y.create.l HWIO_BIMC_M_SYS0_PROF_CONFIGURATION_INFO_0_ADDR A:0x415020
y.create.l HWIO_BIMC_M_SYS0_PROF_CONFIGURATION_INFO_1_ADDR A:0x415030
y.create.l HWIO_BIMC_M_SYS0_PROF_CLOCK_CTRL_ADDR A:0x415200
y.create.l HWIO_BIMC_M_SYS0_PROF_MODE_ADDR A:0x415210
y.create.l HWIO_BIMC_M_SYS0_PROF_RD_TENURE_THRESHOLD_ADDR A:0x415214
y.create.l HWIO_BIMC_M_SYS0_PROF_WR_TENURE_THRESHOLD_ADDR A:0x415218
y.create.l HWIO_BIMC_M_SYS0_PROF_SWAY_SELECT_ADDR A:0x415220
y.create.l HWIO_BIMC_M_SYS0_PROF_MID_MASK_ADDR A:0x415230
y.create.l HWIO_BIMC_M_SYS0_PROF_MID_MATCH_ADDR A:0x415234
y.create.l HWIO_BIMC_M_SYS0_PROF_MID_INV_MATCH_ADDR A:0x415238
y.create.l HWIO_BIMC_M_SYS0_PROF_ADDR_MASK_LOWER_ADDR A:0x415240
y.create.l HWIO_BIMC_M_SYS0_PROF_ADDR_MASK_UPPER_ADDR A:0x415244
y.create.l HWIO_BIMC_M_SYS0_PROF_ADDR_MATCH_LOWER_ADDR A:0x415248
y.create.l HWIO_BIMC_M_SYS0_PROF_ADDR_MATCH_UPPER_ADDR A:0x41524c
y.create.l HWIO_BIMC_M_SYS0_PROF_ADDR_INV_MATCH_ADDR A:0x415250
y.create.l HWIO_BIMC_M_SYS0_PROF_ACH_MASK_0_ADDR A:0x415260
y.create.l HWIO_BIMC_M_SYS0_PROF_ACH_MATCH_0_ADDR A:0x415264
y.create.l HWIO_BIMC_M_SYS0_PROF_ACH_MASK_1_ADDR A:0x415270
y.create.l HWIO_BIMC_M_SYS0_PROF_ACH_MATCH_1_ADDR A:0x415274
y.create.l HWIO_BIMC_M_SYS0_PROF_ACH_INV_MATCH_1_ADDR A:0x415278
y.create.l HWIO_BIMC_M_SYS0_PROF_ACH_MASK_2_ADDR A:0x415280
y.create.l HWIO_BIMC_M_SYS0_PROF_ACH_MATCH_2_ADDR A:0x415284
y.create.l HWIO_BIMC_M_SYS0_PROF_ACH_MASK_3_ADDR A:0x415290
y.create.l HWIO_BIMC_M_SYS0_PROF_ACH_MATCH_3_ADDR A:0x415294
y.create.l HWIO_BIMC_M_SYS0_PROF_ACH_INV_MATCH_3_ADDR A:0x415298
y.create.l HWIO_BIMC_M_SYS0_PROF_ACH_MASK_4_ADDR A:0x4152a0
y.create.l HWIO_BIMC_M_SYS0_PROF_ACH_MATCH_4_ADDR A:0x4152a4
y.create.l HWIO_BIMC_M_SYS0_PROF_ACH_INV_MATCH_4_ADDR A:0x4152a8
y.create.l HWIO_BIMC_M_SYS0_PROF_BCH_MASK_ADDR A:0x415300
y.create.l HWIO_BIMC_M_SYS0_PROF_BCH_MATCH_ADDR A:0x415304
y.create.l HWIO_BIMC_M_SYS0_PROF_BCH_INV_MATCH_ADDR A:0x415308
y.create.l HWIO_BIMC_M_SYS0_PROF_RCH_MASK_ADDR A:0x415340
y.create.l HWIO_BIMC_M_SYS0_PROF_RCH_MATCH_ADDR A:0x415344
y.create.l HWIO_BIMC_M_SYS0_PROF_RCH_INV_MATCH_ADDR A:0x415348
y.create.l HWIO_BIMC_M_SYS0_PROF_RD_STATUS_0_ADDR A:0x415400
y.create.l HWIO_BIMC_M_SYS0_PROF_WR_STATUS_0_ADDR A:0x415410
y.create.l HWIO_BIMC_M_SYS1_MPORT_COMPONENT_INFO_ADDR A:0x418000
y.create.l HWIO_BIMC_M_SYS1_MPORT_CONFIGURATION_INFO_0_ADDR A:0x418020
y.create.l HWIO_BIMC_M_SYS1_MPORT_CONFIGURATION_INFO_1_ADDR A:0x418030
y.create.l HWIO_BIMC_M_SYS1_MPORT_CONFIGURATION_INFO_2A_ADDR A:0x418040
y.create.l HWIO_BIMC_M_SYS1_MPORT_CONFIGURATION_INFO_2B_ADDR A:0x418044
y.create.l HWIO_BIMC_M_SYS1_MPORT_CONFIGURATION_INFO_3_ADDR A:0x418050
y.create.l HWIO_BIMC_M_SYS1_MPORT_CONFIGURATION_INFO_4_ADDR A:0x418060
y.create.l HWIO_BIMC_M_SYS1_MPORT_CONFIGURATION_INFO_5A_ADDR A:0x418070
y.create.l HWIO_BIMC_M_SYS1_MPORT_CONFIGURATION_INFO_5B_ADDR A:0x418074
y.create.l HWIO_BIMC_M_SYS1_MPORT_CONFIGURATION_INFO_5C_ADDR A:0x418078
y.create.l HWIO_BIMC_M_SYS1_MPORT_CONFIGURATION_INFO_5D_ADDR A:0x41807c
y.create.l HWIO_BIMC_M_SYS1_MPORT_INTERRUPT_STATUS_ADDR A:0x418100
y.create.l HWIO_BIMC_M_SYS1_MPORT_INTERRUPT_CLEAR_ADDR A:0x418108
y.create.l HWIO_BIMC_M_SYS1_MPORT_INTERRUPT_ENABLE_ADDR A:0x41810c
y.create.l HWIO_BIMC_M_SYS1_MPORT_CLOCK_CTRL_ADDR A:0x418200
y.create.l HWIO_BIMC_M_SYS1_MPORT_CDC_CTRL_ADDR A:0x418208
y.create.l HWIO_BIMC_M_SYS1_MPORT_MODE_ADDR A:0x418210
y.create.l HWIO_BIMC_M_SYS1_MPORT_WR_WAY_CROSSING_ADDR A:0x418220
y.create.l HWIO_BIMC_M_SYS1_MPORT_PRIORITYLVL_OVERRIDE_ADDR A:0x418230
y.create.l HWIO_BIMC_M_SYS1_MPORT_READ_COMMAND_OVERRIDE_ADDR A:0x418240
y.create.l HWIO_BIMC_M_SYS1_MPORT_WRITE_COMMAND_OVERRIDE_ADDR A:0x418250
y.create.l HWIO_BIMC_M_SYS1_MPORT_RD_TRACKING_INDEX_ADDR A:0x418270
y.create.l HWIO_BIMC_M_SYS1_MPORT_WR_TRACKING_INDEX_ADDR A:0x418274
y.create.l HWIO_BIMC_M_SYS1_MPORT_BWMON_ENABLE_ADDR A:0x418280
y.create.l HWIO_BIMC_M_SYS1_MPORT_BWMON_CLEAR_ADDR A:0x418284
y.create.l HWIO_BIMC_M_SYS1_MPORT_BWMON_BYTE_COUNT_ADDR A:0x418288
y.create.l HWIO_BIMC_M_SYS1_MPORT_BWMON_THRESHOLD_ADDR A:0x418290
y.create.l HWIO_BIMC_M_SYS1_MPORT_BWMON_MID_MASK_ADDR A:0x418298
y.create.l HWIO_BIMC_M_SYS1_MPORT_BWMON_MID_MATCH_ADDR A:0x41829c
y.create.l HWIO_BIMC_M_SYS1_MPORT_BKE_ENABLE_ADDR A:0x418300
y.create.l HWIO_BIMC_M_SYS1_MPORT_BKE_GRANT_PERIOD_ADDR A:0x418304
y.create.l HWIO_BIMC_M_SYS1_MPORT_BKE_GRANT_COUNT_ADDR A:0x418308
y.create.l HWIO_BIMC_M_SYS1_MPORT_BKE_THRESHOLD_HIGH_ADDR A:0x418320
y.create.l HWIO_BIMC_M_SYS1_MPORT_BKE_THRESHOLD_MEDIUM_ADDR A:0x418324
y.create.l HWIO_BIMC_M_SYS1_MPORT_BKE_THRESHOLD_LOW_ADDR A:0x418328
y.create.l HWIO_BIMC_M_SYS1_MPORT_BKE_HEALTH_0_ADDR A:0x418340
y.create.l HWIO_BIMC_M_SYS1_MPORT_BKE_HEALTH_1_ADDR A:0x418344
y.create.l HWIO_BIMC_M_SYS1_MPORT_BKE_HEALTH_2_ADDR A:0x418348
y.create.l HWIO_BIMC_M_SYS1_MPORT_BKE_HEALTH_3_ADDR A:0x41834c
y.create.l HWIO_BIMC_M_SYS1_MPORT_STATUS_2A_ADDR A:0x418420
y.create.l HWIO_BIMC_M_SYS1_MPORT_STATUS_2B_ADDR A:0x418424
y.create.l HWIO_BIMC_M_SYS1_MPORT_STATUS_3A_ADDR A:0x418430
y.create.l HWIO_BIMC_M_SYS1_MPORT_STATUS_3B_ADDR A:0x418434
y.create.l HWIO_BIMC_M_SYS1_MPORT_BKE1_ENABLE_ADDR A:0x418800
y.create.l HWIO_BIMC_M_SYS1_MPORT_BKE1_GRANT_PERIOD_ADDR A:0x418804
y.create.l HWIO_BIMC_M_SYS1_MPORT_BKE1_GRANT_COUNT_ADDR A:0x418808
y.create.l HWIO_BIMC_M_SYS1_MPORT_BKE1_THRESHOLD_HIGH_ADDR A:0x418820
y.create.l HWIO_BIMC_M_SYS1_MPORT_BKE1_THRESHOLD_MEDIUM_ADDR A:0x418824
y.create.l HWIO_BIMC_M_SYS1_MPORT_BKE1_THRESHOLD_LOW_ADDR A:0x418828
y.create.l HWIO_BIMC_M_SYS1_MPORT_BKE1_HEALTH_0_ADDR A:0x418840
y.create.l HWIO_BIMC_M_SYS1_MPORT_BKE1_HEALTH_1_ADDR A:0x418844
y.create.l HWIO_BIMC_M_SYS1_MPORT_BKE1_HEALTH_2_ADDR A:0x418848
y.create.l HWIO_BIMC_M_SYS1_MPORT_BKE1_HEALTH_3_ADDR A:0x41884c
y.create.l HWIO_BIMC_M_SYS1_MPORT_BKE2_ENABLE_ADDR A:0x418900
y.create.l HWIO_BIMC_M_SYS1_MPORT_BKE2_GRANT_PERIOD_ADDR A:0x418904
y.create.l HWIO_BIMC_M_SYS1_MPORT_BKE2_GRANT_COUNT_ADDR A:0x418908
y.create.l HWIO_BIMC_M_SYS1_MPORT_BKE2_THRESHOLD_HIGH_ADDR A:0x418920
y.create.l HWIO_BIMC_M_SYS1_MPORT_BKE2_THRESHOLD_MEDIUM_ADDR A:0x418924
y.create.l HWIO_BIMC_M_SYS1_MPORT_BKE2_THRESHOLD_LOW_ADDR A:0x418928
y.create.l HWIO_BIMC_M_SYS1_MPORT_BKE2_HEALTH_0_ADDR A:0x418940
y.create.l HWIO_BIMC_M_SYS1_MPORT_BKE2_HEALTH_1_ADDR A:0x418944
y.create.l HWIO_BIMC_M_SYS1_MPORT_BKE2_HEALTH_2_ADDR A:0x418948
y.create.l HWIO_BIMC_M_SYS1_MPORT_BKE2_HEALTH_3_ADDR A:0x41894c
y.create.l HWIO_BIMC_M_SYS1_MPORT_BKE3_ENABLE_ADDR A:0x418a00
y.create.l HWIO_BIMC_M_SYS1_MPORT_BKE3_GRANT_PERIOD_ADDR A:0x418a04
y.create.l HWIO_BIMC_M_SYS1_MPORT_BKE3_GRANT_COUNT_ADDR A:0x418a08
y.create.l HWIO_BIMC_M_SYS1_MPORT_BKE3_THRESHOLD_HIGH_ADDR A:0x418a20
y.create.l HWIO_BIMC_M_SYS1_MPORT_BKE3_THRESHOLD_MEDIUM_ADDR A:0x418a24
y.create.l HWIO_BIMC_M_SYS1_MPORT_BKE3_THRESHOLD_LOW_ADDR A:0x418a28
y.create.l HWIO_BIMC_M_SYS1_MPORT_BKE3_HEALTH_0_ADDR A:0x418a40
y.create.l HWIO_BIMC_M_SYS1_MPORT_BKE3_HEALTH_1_ADDR A:0x418a44
y.create.l HWIO_BIMC_M_SYS1_MPORT_BKE3_HEALTH_2_ADDR A:0x418a48
y.create.l HWIO_BIMC_M_SYS1_MPORT_BKE3_HEALTH_3_ADDR A:0x418a4c
y.create.l HWIO_BIMC_M_SYS1_PROF_COMPONENT_INFO_ADDR A:0x419000
y.create.l HWIO_BIMC_M_SYS1_PROF_CONFIGURATION_INFO_0_ADDR A:0x419020
y.create.l HWIO_BIMC_M_SYS1_PROF_CONFIGURATION_INFO_1_ADDR A:0x419030
y.create.l HWIO_BIMC_M_SYS1_PROF_CLOCK_CTRL_ADDR A:0x419200
y.create.l HWIO_BIMC_M_SYS1_PROF_MODE_ADDR A:0x419210
y.create.l HWIO_BIMC_M_SYS1_PROF_RD_TENURE_THRESHOLD_ADDR A:0x419214
y.create.l HWIO_BIMC_M_SYS1_PROF_WR_TENURE_THRESHOLD_ADDR A:0x419218
y.create.l HWIO_BIMC_M_SYS1_PROF_SWAY_SELECT_ADDR A:0x419220
y.create.l HWIO_BIMC_M_SYS1_PROF_MID_MASK_ADDR A:0x419230
y.create.l HWIO_BIMC_M_SYS1_PROF_MID_MATCH_ADDR A:0x419234
y.create.l HWIO_BIMC_M_SYS1_PROF_MID_INV_MATCH_ADDR A:0x419238
y.create.l HWIO_BIMC_M_SYS1_PROF_ADDR_MASK_LOWER_ADDR A:0x419240
y.create.l HWIO_BIMC_M_SYS1_PROF_ADDR_MASK_UPPER_ADDR A:0x419244
y.create.l HWIO_BIMC_M_SYS1_PROF_ADDR_MATCH_LOWER_ADDR A:0x419248
y.create.l HWIO_BIMC_M_SYS1_PROF_ADDR_MATCH_UPPER_ADDR A:0x41924c
y.create.l HWIO_BIMC_M_SYS1_PROF_ADDR_INV_MATCH_ADDR A:0x419250
y.create.l HWIO_BIMC_M_SYS1_PROF_ACH_MASK_0_ADDR A:0x419260
y.create.l HWIO_BIMC_M_SYS1_PROF_ACH_MATCH_0_ADDR A:0x419264
y.create.l HWIO_BIMC_M_SYS1_PROF_ACH_MASK_1_ADDR A:0x419270
y.create.l HWIO_BIMC_M_SYS1_PROF_ACH_MATCH_1_ADDR A:0x419274
y.create.l HWIO_BIMC_M_SYS1_PROF_ACH_INV_MATCH_1_ADDR A:0x419278
y.create.l HWIO_BIMC_M_SYS1_PROF_ACH_MASK_2_ADDR A:0x419280
y.create.l HWIO_BIMC_M_SYS1_PROF_ACH_MATCH_2_ADDR A:0x419284
y.create.l HWIO_BIMC_M_SYS1_PROF_ACH_MASK_3_ADDR A:0x419290
y.create.l HWIO_BIMC_M_SYS1_PROF_ACH_MATCH_3_ADDR A:0x419294
y.create.l HWIO_BIMC_M_SYS1_PROF_ACH_INV_MATCH_3_ADDR A:0x419298
y.create.l HWIO_BIMC_M_SYS1_PROF_ACH_MASK_4_ADDR A:0x4192a0
y.create.l HWIO_BIMC_M_SYS1_PROF_ACH_MATCH_4_ADDR A:0x4192a4
y.create.l HWIO_BIMC_M_SYS1_PROF_ACH_INV_MATCH_4_ADDR A:0x4192a8
y.create.l HWIO_BIMC_M_SYS1_PROF_BCH_MASK_ADDR A:0x419300
y.create.l HWIO_BIMC_M_SYS1_PROF_BCH_MATCH_ADDR A:0x419304
y.create.l HWIO_BIMC_M_SYS1_PROF_BCH_INV_MATCH_ADDR A:0x419308
y.create.l HWIO_BIMC_M_SYS1_PROF_RCH_MASK_ADDR A:0x419340
y.create.l HWIO_BIMC_M_SYS1_PROF_RCH_MATCH_ADDR A:0x419344
y.create.l HWIO_BIMC_M_SYS1_PROF_RCH_INV_MATCH_ADDR A:0x419348
y.create.l HWIO_BIMC_M_SYS1_PROF_RD_STATUS_0_ADDR A:0x419400
y.create.l HWIO_BIMC_M_SYS1_PROF_WR_STATUS_0_ADDR A:0x419410
y.create.l HWIO_BIMC_M_TCU0_MPORT_COMPONENT_INFO_ADDR A:0x41c000
y.create.l HWIO_BIMC_M_TCU0_MPORT_CONFIGURATION_INFO_0_ADDR A:0x41c020
y.create.l HWIO_BIMC_M_TCU0_MPORT_CONFIGURATION_INFO_1_ADDR A:0x41c030
y.create.l HWIO_BIMC_M_TCU0_MPORT_CONFIGURATION_INFO_2A_ADDR A:0x41c040
y.create.l HWIO_BIMC_M_TCU0_MPORT_CONFIGURATION_INFO_2B_ADDR A:0x41c044
y.create.l HWIO_BIMC_M_TCU0_MPORT_CONFIGURATION_INFO_3_ADDR A:0x41c050
y.create.l HWIO_BIMC_M_TCU0_MPORT_CONFIGURATION_INFO_4_ADDR A:0x41c060
y.create.l HWIO_BIMC_M_TCU0_MPORT_CONFIGURATION_INFO_5A_ADDR A:0x41c070
y.create.l HWIO_BIMC_M_TCU0_MPORT_CONFIGURATION_INFO_5B_ADDR A:0x41c074
y.create.l HWIO_BIMC_M_TCU0_MPORT_CONFIGURATION_INFO_5C_ADDR A:0x41c078
y.create.l HWIO_BIMC_M_TCU0_MPORT_CONFIGURATION_INFO_5D_ADDR A:0x41c07c
y.create.l HWIO_BIMC_M_TCU0_MPORT_INTERRUPT_STATUS_ADDR A:0x41c100
y.create.l HWIO_BIMC_M_TCU0_MPORT_INTERRUPT_CLEAR_ADDR A:0x41c108
y.create.l HWIO_BIMC_M_TCU0_MPORT_INTERRUPT_ENABLE_ADDR A:0x41c10c
y.create.l HWIO_BIMC_M_TCU0_MPORT_CLOCK_CTRL_ADDR A:0x41c200
y.create.l HWIO_BIMC_M_TCU0_MPORT_CDC_CTRL_ADDR A:0x41c208
y.create.l HWIO_BIMC_M_TCU0_MPORT_MODE_ADDR A:0x41c210
y.create.l HWIO_BIMC_M_TCU0_MPORT_WR_WAY_CROSSING_ADDR A:0x41c220
y.create.l HWIO_BIMC_M_TCU0_MPORT_PRIORITYLVL_OVERRIDE_ADDR A:0x41c230
y.create.l HWIO_BIMC_M_TCU0_MPORT_READ_COMMAND_OVERRIDE_ADDR A:0x41c240
y.create.l HWIO_BIMC_M_TCU0_MPORT_WRITE_COMMAND_OVERRIDE_ADDR A:0x41c250
y.create.l HWIO_BIMC_M_TCU0_MPORT_RD_TRACKING_INDEX_ADDR A:0x41c270
y.create.l HWIO_BIMC_M_TCU0_MPORT_WR_TRACKING_INDEX_ADDR A:0x41c274
y.create.l HWIO_BIMC_M_TCU0_MPORT_BWMON_ENABLE_ADDR A:0x41c280
y.create.l HWIO_BIMC_M_TCU0_MPORT_BWMON_CLEAR_ADDR A:0x41c284
y.create.l HWIO_BIMC_M_TCU0_MPORT_BWMON_BYTE_COUNT_ADDR A:0x41c288
y.create.l HWIO_BIMC_M_TCU0_MPORT_BWMON_THRESHOLD_ADDR A:0x41c290
y.create.l HWIO_BIMC_M_TCU0_MPORT_BWMON_MID_MASK_ADDR A:0x41c298
y.create.l HWIO_BIMC_M_TCU0_MPORT_BWMON_MID_MATCH_ADDR A:0x41c29c
y.create.l HWIO_BIMC_M_TCU0_MPORT_BKE_ENABLE_ADDR A:0x41c300
y.create.l HWIO_BIMC_M_TCU0_MPORT_BKE_GRANT_PERIOD_ADDR A:0x41c304
y.create.l HWIO_BIMC_M_TCU0_MPORT_BKE_GRANT_COUNT_ADDR A:0x41c308
y.create.l HWIO_BIMC_M_TCU0_MPORT_BKE_THRESHOLD_HIGH_ADDR A:0x41c320
y.create.l HWIO_BIMC_M_TCU0_MPORT_BKE_THRESHOLD_MEDIUM_ADDR A:0x41c324
y.create.l HWIO_BIMC_M_TCU0_MPORT_BKE_THRESHOLD_LOW_ADDR A:0x41c328
y.create.l HWIO_BIMC_M_TCU0_MPORT_BKE_HEALTH_0_ADDR A:0x41c340
y.create.l HWIO_BIMC_M_TCU0_MPORT_BKE_HEALTH_1_ADDR A:0x41c344
y.create.l HWIO_BIMC_M_TCU0_MPORT_BKE_HEALTH_2_ADDR A:0x41c348
y.create.l HWIO_BIMC_M_TCU0_MPORT_BKE_HEALTH_3_ADDR A:0x41c34c
y.create.l HWIO_BIMC_M_TCU0_MPORT_STATUS_2A_ADDR A:0x41c420
y.create.l HWIO_BIMC_M_TCU0_MPORT_STATUS_2B_ADDR A:0x41c424
y.create.l HWIO_BIMC_M_TCU0_MPORT_STATUS_3A_ADDR A:0x41c430
y.create.l HWIO_BIMC_M_TCU0_MPORT_STATUS_3B_ADDR A:0x41c434
y.create.l HWIO_BIMC_M_TCU0_MPORT_BKE1_ENABLE_ADDR A:0x41c800
y.create.l HWIO_BIMC_M_TCU0_MPORT_BKE1_GRANT_PERIOD_ADDR A:0x41c804
y.create.l HWIO_BIMC_M_TCU0_MPORT_BKE1_GRANT_COUNT_ADDR A:0x41c808
y.create.l HWIO_BIMC_M_TCU0_MPORT_BKE1_THRESHOLD_HIGH_ADDR A:0x41c820
y.create.l HWIO_BIMC_M_TCU0_MPORT_BKE1_THRESHOLD_MEDIUM_ADDR A:0x41c824
y.create.l HWIO_BIMC_M_TCU0_MPORT_BKE1_THRESHOLD_LOW_ADDR A:0x41c828
y.create.l HWIO_BIMC_M_TCU0_MPORT_BKE1_HEALTH_0_ADDR A:0x41c840
y.create.l HWIO_BIMC_M_TCU0_MPORT_BKE1_HEALTH_1_ADDR A:0x41c844
y.create.l HWIO_BIMC_M_TCU0_MPORT_BKE1_HEALTH_2_ADDR A:0x41c848
y.create.l HWIO_BIMC_M_TCU0_MPORT_BKE1_HEALTH_3_ADDR A:0x41c84c
y.create.l HWIO_BIMC_M_TCU0_MPORT_BKE2_ENABLE_ADDR A:0x41c900
y.create.l HWIO_BIMC_M_TCU0_MPORT_BKE2_GRANT_PERIOD_ADDR A:0x41c904
y.create.l HWIO_BIMC_M_TCU0_MPORT_BKE2_GRANT_COUNT_ADDR A:0x41c908
y.create.l HWIO_BIMC_M_TCU0_MPORT_BKE2_THRESHOLD_HIGH_ADDR A:0x41c920
y.create.l HWIO_BIMC_M_TCU0_MPORT_BKE2_THRESHOLD_MEDIUM_ADDR A:0x41c924
y.create.l HWIO_BIMC_M_TCU0_MPORT_BKE2_THRESHOLD_LOW_ADDR A:0x41c928
y.create.l HWIO_BIMC_M_TCU0_MPORT_BKE2_HEALTH_0_ADDR A:0x41c940
y.create.l HWIO_BIMC_M_TCU0_MPORT_BKE2_HEALTH_1_ADDR A:0x41c944
y.create.l HWIO_BIMC_M_TCU0_MPORT_BKE2_HEALTH_2_ADDR A:0x41c948
y.create.l HWIO_BIMC_M_TCU0_MPORT_BKE2_HEALTH_3_ADDR A:0x41c94c
y.create.l HWIO_BIMC_M_TCU0_MPORT_BKE3_ENABLE_ADDR A:0x41ca00
y.create.l HWIO_BIMC_M_TCU0_MPORT_BKE3_GRANT_PERIOD_ADDR A:0x41ca04
y.create.l HWIO_BIMC_M_TCU0_MPORT_BKE3_GRANT_COUNT_ADDR A:0x41ca08
y.create.l HWIO_BIMC_M_TCU0_MPORT_BKE3_THRESHOLD_HIGH_ADDR A:0x41ca20
y.create.l HWIO_BIMC_M_TCU0_MPORT_BKE3_THRESHOLD_MEDIUM_ADDR A:0x41ca24
y.create.l HWIO_BIMC_M_TCU0_MPORT_BKE3_THRESHOLD_LOW_ADDR A:0x41ca28
y.create.l HWIO_BIMC_M_TCU0_MPORT_BKE3_HEALTH_0_ADDR A:0x41ca40
y.create.l HWIO_BIMC_M_TCU0_MPORT_BKE3_HEALTH_1_ADDR A:0x41ca44
y.create.l HWIO_BIMC_M_TCU0_MPORT_BKE3_HEALTH_2_ADDR A:0x41ca48
y.create.l HWIO_BIMC_M_TCU0_MPORT_BKE3_HEALTH_3_ADDR A:0x41ca4c
y.create.l HWIO_BIMC_M_TCU0_PROF_COMPONENT_INFO_ADDR A:0x41d000
y.create.l HWIO_BIMC_M_TCU0_PROF_CONFIGURATION_INFO_0_ADDR A:0x41d020
y.create.l HWIO_BIMC_M_TCU0_PROF_CONFIGURATION_INFO_1_ADDR A:0x41d030
y.create.l HWIO_BIMC_M_TCU0_PROF_CLOCK_CTRL_ADDR A:0x41d200
y.create.l HWIO_BIMC_M_TCU0_PROF_MODE_ADDR A:0x41d210
y.create.l HWIO_BIMC_M_TCU0_PROF_RD_TENURE_THRESHOLD_ADDR A:0x41d214
y.create.l HWIO_BIMC_M_TCU0_PROF_WR_TENURE_THRESHOLD_ADDR A:0x41d218
y.create.l HWIO_BIMC_M_TCU0_PROF_SWAY_SELECT_ADDR A:0x41d220
y.create.l HWIO_BIMC_M_TCU0_PROF_MID_MASK_ADDR A:0x41d230
y.create.l HWIO_BIMC_M_TCU0_PROF_MID_MATCH_ADDR A:0x41d234
y.create.l HWIO_BIMC_M_TCU0_PROF_MID_INV_MATCH_ADDR A:0x41d238
y.create.l HWIO_BIMC_M_TCU0_PROF_ADDR_MASK_LOWER_ADDR A:0x41d240
y.create.l HWIO_BIMC_M_TCU0_PROF_ADDR_MASK_UPPER_ADDR A:0x41d244
y.create.l HWIO_BIMC_M_TCU0_PROF_ADDR_MATCH_LOWER_ADDR A:0x41d248
y.create.l HWIO_BIMC_M_TCU0_PROF_ADDR_MATCH_UPPER_ADDR A:0x41d24c
y.create.l HWIO_BIMC_M_TCU0_PROF_ADDR_INV_MATCH_ADDR A:0x41d250
y.create.l HWIO_BIMC_M_TCU0_PROF_ACH_MASK_0_ADDR A:0x41d260
y.create.l HWIO_BIMC_M_TCU0_PROF_ACH_MATCH_0_ADDR A:0x41d264
y.create.l HWIO_BIMC_M_TCU0_PROF_ACH_MASK_1_ADDR A:0x41d270
y.create.l HWIO_BIMC_M_TCU0_PROF_ACH_MATCH_1_ADDR A:0x41d274
y.create.l HWIO_BIMC_M_TCU0_PROF_ACH_INV_MATCH_1_ADDR A:0x41d278
y.create.l HWIO_BIMC_M_TCU0_PROF_ACH_MASK_2_ADDR A:0x41d280
y.create.l HWIO_BIMC_M_TCU0_PROF_ACH_MATCH_2_ADDR A:0x41d284
y.create.l HWIO_BIMC_M_TCU0_PROF_ACH_MASK_3_ADDR A:0x41d290
y.create.l HWIO_BIMC_M_TCU0_PROF_ACH_MATCH_3_ADDR A:0x41d294
y.create.l HWIO_BIMC_M_TCU0_PROF_ACH_INV_MATCH_3_ADDR A:0x41d298
y.create.l HWIO_BIMC_M_TCU0_PROF_ACH_MASK_4_ADDR A:0x41d2a0
y.create.l HWIO_BIMC_M_TCU0_PROF_ACH_MATCH_4_ADDR A:0x41d2a4
y.create.l HWIO_BIMC_M_TCU0_PROF_ACH_INV_MATCH_4_ADDR A:0x41d2a8
y.create.l HWIO_BIMC_M_TCU0_PROF_BCH_MASK_ADDR A:0x41d300
y.create.l HWIO_BIMC_M_TCU0_PROF_BCH_MATCH_ADDR A:0x41d304
y.create.l HWIO_BIMC_M_TCU0_PROF_BCH_INV_MATCH_ADDR A:0x41d308
y.create.l HWIO_BIMC_M_TCU0_PROF_RCH_MASK_ADDR A:0x41d340
y.create.l HWIO_BIMC_M_TCU0_PROF_RCH_MATCH_ADDR A:0x41d344
y.create.l HWIO_BIMC_M_TCU0_PROF_RCH_INV_MATCH_ADDR A:0x41d348
y.create.l HWIO_BIMC_M_TCU0_PROF_RD_STATUS_0_ADDR A:0x41d400
y.create.l HWIO_BIMC_M_TCU0_PROF_WR_STATUS_0_ADDR A:0x41d410
y.create.l HWIO_BIMC_M_TCU1_MPORT_COMPONENT_INFO_ADDR A:0x420000
y.create.l HWIO_BIMC_M_TCU1_MPORT_CONFIGURATION_INFO_0_ADDR A:0x420020
y.create.l HWIO_BIMC_M_TCU1_MPORT_CONFIGURATION_INFO_1_ADDR A:0x420030
y.create.l HWIO_BIMC_M_TCU1_MPORT_CONFIGURATION_INFO_2A_ADDR A:0x420040
y.create.l HWIO_BIMC_M_TCU1_MPORT_CONFIGURATION_INFO_2B_ADDR A:0x420044
y.create.l HWIO_BIMC_M_TCU1_MPORT_CONFIGURATION_INFO_3_ADDR A:0x420050
y.create.l HWIO_BIMC_M_TCU1_MPORT_CONFIGURATION_INFO_4_ADDR A:0x420060
y.create.l HWIO_BIMC_M_TCU1_MPORT_CONFIGURATION_INFO_5A_ADDR A:0x420070
y.create.l HWIO_BIMC_M_TCU1_MPORT_CONFIGURATION_INFO_5B_ADDR A:0x420074
y.create.l HWIO_BIMC_M_TCU1_MPORT_CONFIGURATION_INFO_5C_ADDR A:0x420078
y.create.l HWIO_BIMC_M_TCU1_MPORT_CONFIGURATION_INFO_5D_ADDR A:0x42007c
y.create.l HWIO_BIMC_M_TCU1_MPORT_INTERRUPT_STATUS_ADDR A:0x420100
y.create.l HWIO_BIMC_M_TCU1_MPORT_INTERRUPT_CLEAR_ADDR A:0x420108
y.create.l HWIO_BIMC_M_TCU1_MPORT_INTERRUPT_ENABLE_ADDR A:0x42010c
y.create.l HWIO_BIMC_M_TCU1_MPORT_CLOCK_CTRL_ADDR A:0x420200
y.create.l HWIO_BIMC_M_TCU1_MPORT_CDC_CTRL_ADDR A:0x420208
y.create.l HWIO_BIMC_M_TCU1_MPORT_MODE_ADDR A:0x420210
y.create.l HWIO_BIMC_M_TCU1_MPORT_WR_WAY_CROSSING_ADDR A:0x420220
y.create.l HWIO_BIMC_M_TCU1_MPORT_PRIORITYLVL_OVERRIDE_ADDR A:0x420230
y.create.l HWIO_BIMC_M_TCU1_MPORT_READ_COMMAND_OVERRIDE_ADDR A:0x420240
y.create.l HWIO_BIMC_M_TCU1_MPORT_WRITE_COMMAND_OVERRIDE_ADDR A:0x420250
y.create.l HWIO_BIMC_M_TCU1_MPORT_RD_TRACKING_INDEX_ADDR A:0x420270
y.create.l HWIO_BIMC_M_TCU1_MPORT_WR_TRACKING_INDEX_ADDR A:0x420274
y.create.l HWIO_BIMC_M_TCU1_MPORT_BWMON_ENABLE_ADDR A:0x420280
y.create.l HWIO_BIMC_M_TCU1_MPORT_BWMON_CLEAR_ADDR A:0x420284
y.create.l HWIO_BIMC_M_TCU1_MPORT_BWMON_BYTE_COUNT_ADDR A:0x420288
y.create.l HWIO_BIMC_M_TCU1_MPORT_BWMON_THRESHOLD_ADDR A:0x420290
y.create.l HWIO_BIMC_M_TCU1_MPORT_BWMON_MID_MASK_ADDR A:0x420298
y.create.l HWIO_BIMC_M_TCU1_MPORT_BWMON_MID_MATCH_ADDR A:0x42029c
y.create.l HWIO_BIMC_M_TCU1_MPORT_BKE_ENABLE_ADDR A:0x420300
y.create.l HWIO_BIMC_M_TCU1_MPORT_BKE_GRANT_PERIOD_ADDR A:0x420304
y.create.l HWIO_BIMC_M_TCU1_MPORT_BKE_GRANT_COUNT_ADDR A:0x420308
y.create.l HWIO_BIMC_M_TCU1_MPORT_BKE_THRESHOLD_HIGH_ADDR A:0x420320
y.create.l HWIO_BIMC_M_TCU1_MPORT_BKE_THRESHOLD_MEDIUM_ADDR A:0x420324
y.create.l HWIO_BIMC_M_TCU1_MPORT_BKE_THRESHOLD_LOW_ADDR A:0x420328
y.create.l HWIO_BIMC_M_TCU1_MPORT_BKE_HEALTH_0_ADDR A:0x420340
y.create.l HWIO_BIMC_M_TCU1_MPORT_BKE_HEALTH_1_ADDR A:0x420344
y.create.l HWIO_BIMC_M_TCU1_MPORT_BKE_HEALTH_2_ADDR A:0x420348
y.create.l HWIO_BIMC_M_TCU1_MPORT_BKE_HEALTH_3_ADDR A:0x42034c
y.create.l HWIO_BIMC_M_TCU1_MPORT_STATUS_2A_ADDR A:0x420420
y.create.l HWIO_BIMC_M_TCU1_MPORT_STATUS_2B_ADDR A:0x420424
y.create.l HWIO_BIMC_M_TCU1_MPORT_STATUS_3A_ADDR A:0x420430
y.create.l HWIO_BIMC_M_TCU1_MPORT_STATUS_3B_ADDR A:0x420434
y.create.l HWIO_BIMC_M_TCU1_MPORT_BKE1_ENABLE_ADDR A:0x420800
y.create.l HWIO_BIMC_M_TCU1_MPORT_BKE1_GRANT_PERIOD_ADDR A:0x420804
y.create.l HWIO_BIMC_M_TCU1_MPORT_BKE1_GRANT_COUNT_ADDR A:0x420808
y.create.l HWIO_BIMC_M_TCU1_MPORT_BKE1_THRESHOLD_HIGH_ADDR A:0x420820
y.create.l HWIO_BIMC_M_TCU1_MPORT_BKE1_THRESHOLD_MEDIUM_ADDR A:0x420824
y.create.l HWIO_BIMC_M_TCU1_MPORT_BKE1_THRESHOLD_LOW_ADDR A:0x420828
y.create.l HWIO_BIMC_M_TCU1_MPORT_BKE1_HEALTH_0_ADDR A:0x420840
y.create.l HWIO_BIMC_M_TCU1_MPORT_BKE1_HEALTH_1_ADDR A:0x420844
y.create.l HWIO_BIMC_M_TCU1_MPORT_BKE1_HEALTH_2_ADDR A:0x420848
y.create.l HWIO_BIMC_M_TCU1_MPORT_BKE1_HEALTH_3_ADDR A:0x42084c
y.create.l HWIO_BIMC_M_TCU1_MPORT_BKE2_ENABLE_ADDR A:0x420900
y.create.l HWIO_BIMC_M_TCU1_MPORT_BKE2_GRANT_PERIOD_ADDR A:0x420904
y.create.l HWIO_BIMC_M_TCU1_MPORT_BKE2_GRANT_COUNT_ADDR A:0x420908
y.create.l HWIO_BIMC_M_TCU1_MPORT_BKE2_THRESHOLD_HIGH_ADDR A:0x420920
y.create.l HWIO_BIMC_M_TCU1_MPORT_BKE2_THRESHOLD_MEDIUM_ADDR A:0x420924
y.create.l HWIO_BIMC_M_TCU1_MPORT_BKE2_THRESHOLD_LOW_ADDR A:0x420928
y.create.l HWIO_BIMC_M_TCU1_MPORT_BKE2_HEALTH_0_ADDR A:0x420940
y.create.l HWIO_BIMC_M_TCU1_MPORT_BKE2_HEALTH_1_ADDR A:0x420944
y.create.l HWIO_BIMC_M_TCU1_MPORT_BKE2_HEALTH_2_ADDR A:0x420948
y.create.l HWIO_BIMC_M_TCU1_MPORT_BKE2_HEALTH_3_ADDR A:0x42094c
y.create.l HWIO_BIMC_M_TCU1_MPORT_BKE3_ENABLE_ADDR A:0x420a00
y.create.l HWIO_BIMC_M_TCU1_MPORT_BKE3_GRANT_PERIOD_ADDR A:0x420a04
y.create.l HWIO_BIMC_M_TCU1_MPORT_BKE3_GRANT_COUNT_ADDR A:0x420a08
y.create.l HWIO_BIMC_M_TCU1_MPORT_BKE3_THRESHOLD_HIGH_ADDR A:0x420a20
y.create.l HWIO_BIMC_M_TCU1_MPORT_BKE3_THRESHOLD_MEDIUM_ADDR A:0x420a24
y.create.l HWIO_BIMC_M_TCU1_MPORT_BKE3_THRESHOLD_LOW_ADDR A:0x420a28
y.create.l HWIO_BIMC_M_TCU1_MPORT_BKE3_HEALTH_0_ADDR A:0x420a40
y.create.l HWIO_BIMC_M_TCU1_MPORT_BKE3_HEALTH_1_ADDR A:0x420a44
y.create.l HWIO_BIMC_M_TCU1_MPORT_BKE3_HEALTH_2_ADDR A:0x420a48
y.create.l HWIO_BIMC_M_TCU1_MPORT_BKE3_HEALTH_3_ADDR A:0x420a4c
y.create.l HWIO_BIMC_M_TCU1_PROF_COMPONENT_INFO_ADDR A:0x421000
y.create.l HWIO_BIMC_M_TCU1_PROF_CONFIGURATION_INFO_0_ADDR A:0x421020
y.create.l HWIO_BIMC_M_TCU1_PROF_CONFIGURATION_INFO_1_ADDR A:0x421030
y.create.l HWIO_BIMC_M_TCU1_PROF_CLOCK_CTRL_ADDR A:0x421200
y.create.l HWIO_BIMC_M_TCU1_PROF_MODE_ADDR A:0x421210
y.create.l HWIO_BIMC_M_TCU1_PROF_RD_TENURE_THRESHOLD_ADDR A:0x421214
y.create.l HWIO_BIMC_M_TCU1_PROF_WR_TENURE_THRESHOLD_ADDR A:0x421218
y.create.l HWIO_BIMC_M_TCU1_PROF_SWAY_SELECT_ADDR A:0x421220
y.create.l HWIO_BIMC_M_TCU1_PROF_MID_MASK_ADDR A:0x421230
y.create.l HWIO_BIMC_M_TCU1_PROF_MID_MATCH_ADDR A:0x421234
y.create.l HWIO_BIMC_M_TCU1_PROF_MID_INV_MATCH_ADDR A:0x421238
y.create.l HWIO_BIMC_M_TCU1_PROF_ADDR_MASK_LOWER_ADDR A:0x421240
y.create.l HWIO_BIMC_M_TCU1_PROF_ADDR_MASK_UPPER_ADDR A:0x421244
y.create.l HWIO_BIMC_M_TCU1_PROF_ADDR_MATCH_LOWER_ADDR A:0x421248
y.create.l HWIO_BIMC_M_TCU1_PROF_ADDR_MATCH_UPPER_ADDR A:0x42124c
y.create.l HWIO_BIMC_M_TCU1_PROF_ADDR_INV_MATCH_ADDR A:0x421250
y.create.l HWIO_BIMC_M_TCU1_PROF_ACH_MASK_0_ADDR A:0x421260
y.create.l HWIO_BIMC_M_TCU1_PROF_ACH_MATCH_0_ADDR A:0x421264
y.create.l HWIO_BIMC_M_TCU1_PROF_ACH_MASK_1_ADDR A:0x421270
y.create.l HWIO_BIMC_M_TCU1_PROF_ACH_MATCH_1_ADDR A:0x421274
y.create.l HWIO_BIMC_M_TCU1_PROF_ACH_INV_MATCH_1_ADDR A:0x421278
y.create.l HWIO_BIMC_M_TCU1_PROF_ACH_MASK_2_ADDR A:0x421280
y.create.l HWIO_BIMC_M_TCU1_PROF_ACH_MATCH_2_ADDR A:0x421284
y.create.l HWIO_BIMC_M_TCU1_PROF_ACH_MASK_3_ADDR A:0x421290
y.create.l HWIO_BIMC_M_TCU1_PROF_ACH_MATCH_3_ADDR A:0x421294
y.create.l HWIO_BIMC_M_TCU1_PROF_ACH_INV_MATCH_3_ADDR A:0x421298
y.create.l HWIO_BIMC_M_TCU1_PROF_ACH_MASK_4_ADDR A:0x4212a0
y.create.l HWIO_BIMC_M_TCU1_PROF_ACH_MATCH_4_ADDR A:0x4212a4
y.create.l HWIO_BIMC_M_TCU1_PROF_ACH_INV_MATCH_4_ADDR A:0x4212a8
y.create.l HWIO_BIMC_M_TCU1_PROF_BCH_MASK_ADDR A:0x421300
y.create.l HWIO_BIMC_M_TCU1_PROF_BCH_MATCH_ADDR A:0x421304
y.create.l HWIO_BIMC_M_TCU1_PROF_BCH_INV_MATCH_ADDR A:0x421308
y.create.l HWIO_BIMC_M_TCU1_PROF_RCH_MASK_ADDR A:0x421340
y.create.l HWIO_BIMC_M_TCU1_PROF_RCH_MATCH_ADDR A:0x421344
y.create.l HWIO_BIMC_M_TCU1_PROF_RCH_INV_MATCH_ADDR A:0x421348
y.create.l HWIO_BIMC_M_TCU1_PROF_RD_STATUS_0_ADDR A:0x421400
y.create.l HWIO_BIMC_M_TCU1_PROF_WR_STATUS_0_ADDR A:0x421410
y.create.l HWIO_BIMC_S_SYS_SWAY_COMPONENT_INFO_ADDR A:0x450000
y.create.l HWIO_BIMC_S_SYS_SWAY_CONFIGURATION_INFO_0_ADDR A:0x450020
y.create.l HWIO_BIMC_S_SYS_SWAY_CONFIGURATION_INFO_1_ADDR A:0x450030
y.create.l HWIO_BIMC_S_SYS_SWAY_CONFIGURATION_INFO_2_ADDR A:0x450040
y.create.l HWIO_BIMC_S_SYS_SWAY_CONFIGURATION_INFO_3_ADDR A:0x450050
y.create.l HWIO_BIMC_S_SYS_SWAY_CONFIGURATION_INFO_4_ADDR A:0x450060
y.create.l HWIO_BIMC_S_SYS_SWAY_CONFIGURATION_INFO_5_ADDR A:0x450070
y.create.l HWIO_BIMC_S_SYS_SWAY_CONFIGURATION_INFO_6A_ADDR A:0x450080
y.create.l HWIO_BIMC_S_SYS_SWAY_CONFIGURATION_INFO_6B_ADDR A:0x450084
y.create.l HWIO_BIMC_S_SYS_SWAY_CONFIGURATION_INFO_6C_ADDR A:0x450088
y.create.l HWIO_BIMC_S_SYS_SWAY_CONFIGURATION_INFO_6D_ADDR A:0x45008c
y.create.l HWIO_BIMC_S_SYS_SWAY_INTERRUPT_STATUS_ADDR A:0x450100
y.create.l HWIO_BIMC_S_SYS_SWAY_INTERRUPT_CLEAR_ADDR A:0x450108
y.create.l HWIO_BIMC_S_SYS_SWAY_INTERRUPT_ENABLE_ADDR A:0x45010c
y.create.l HWIO_BIMC_S_SYS_SWAY_CLOCK_CTRL_ADDR A:0x450200
y.create.l HWIO_BIMC_S_SYS_SWAY_CDC_CTRL_ADDR A:0x450208
y.create.l HWIO_BIMC_S_SYS_SWAY_RCH_SELECT_ADDR A:0x450210
y.create.l HWIO_BIMC_S_SYS_SWAY_MAX_OUTSTANDING_REQUESTS_ADDR A:0x450220
y.create.l HWIO_BIMC_S_SYS_SWAY_GATHERING_ADDR A:0x450230
y.create.l HWIO_BIMC_S_SYS_SWAY_MODE_ADDR A:0x450240
y.create.l HWIO_BIMC_S_SYS_SWAY_READ_COMMAND_OVERRIDE_ADDR A:0x450250
y.create.l HWIO_BIMC_S_SYS_SWAY_WRITE_COMMAND_OVERRIDE_ADDR A:0x450260
y.create.l HWIO_BIMC_S_SYS_SWAY_STATUS_0A_ADDR A:0x450400
y.create.l HWIO_BIMC_S_SYS_SWAY_STATUS_0B_ADDR A:0x450404
y.create.l HWIO_BIMC_S_SYS_SWAY_STATUS_0C_ADDR A:0x450408
y.create.l HWIO_BIMC_S_SYS_SWAY_STATUS_0D_ADDR A:0x45040c
y.create.l HWIO_BIMC_S_SYS_SWAY_STATUS_1A_ADDR A:0x450410
y.create.l HWIO_BIMC_S_SYS_SWAY_STATUS_1B_ADDR A:0x450414
y.create.l HWIO_BIMC_S_SYS_SWAY_STATUS_1C_ADDR A:0x450418
y.create.l HWIO_BIMC_S_DEFAULT_SWAY_COMPONENT_INFO_ADDR A:0x458000
y.create.l HWIO_BIMC_S_DEFAULT_SWAY_CONFIGURATION_INFO_0_ADDR A:0x458020
y.create.l HWIO_BIMC_S_DEFAULT_SWAY_CONFIGURATION_INFO_1_ADDR A:0x458030
y.create.l HWIO_BIMC_S_DEFAULT_SWAY_INTERRUPT_STATUS_ADDR A:0x458100
y.create.l HWIO_BIMC_S_DEFAULT_SWAY_INTERRUPT_CLEAR_ADDR A:0x458108
y.create.l HWIO_BIMC_S_DEFAULT_SWAY_INTERRUPT_ENABLE_ADDR A:0x45810c
y.create.l HWIO_BIMC_S_DEFAULT_SWAY_DEFAULT_SLAVE_STATUS_0_ADDR A:0x458400
y.create.l HWIO_BIMC_S_DEFAULT_SWAY_DEFAULT_SLAVE_STATUS_1_ADDR A:0x458410
y.create.l HWIO_BIMC_S_DEFAULT_SWAY_DEFAULT_SLAVE_STATUS_2_ADDR A:0x458420
y.create.l HWIO_BIMC_S_DDR0_ARB_COMPONENT_INFO_ADDR A:0x449000
y.create.l HWIO_BIMC_S_DDR0_ARB_CONFIGURATION_INFO_0_ADDR A:0x449020
y.create.l HWIO_BIMC_S_DDR0_ARB_CONFIGURATION_INFO_1_ADDR A:0x449030
y.create.l HWIO_BIMC_S_DDR0_ARB_CLOCK_CTRL_ADDR A:0x449200
y.create.l HWIO_BIMC_S_DDR0_ARB_MODE_ADDR A:0x449210
y.create.l HWIO_BIMC_S_DDR0_ARB_MASTER0_GRANTS_ADDR A:0x449220
y.create.l HWIO_BIMC_S_DDR0_ARB_MASTER1_GRANTS_ADDR A:0x449224
y.create.l HWIO_BIMC_S_DDR0_ARB_MASTER2_GRANTS_ADDR A:0x449228
y.create.l HWIO_BIMC_S_DDR0_ARB_MASTER3_GRANTS_ADDR A:0x44922c
y.create.l HWIO_BIMC_S_DDR0_ARB_MASTER4_GRANTS_ADDR A:0x449230
y.create.l HWIO_BIMC_S_DDR0_ARB_MASTER5_GRANTS_ADDR A:0x449234
y.create.l HWIO_BIMC_S_DDR0_ARB_MASTER6_GRANTS_ADDR A:0x449238
y.create.l HWIO_BIMC_S_SYS_ARB_COMPONENT_INFO_ADDR A:0x451000
y.create.l HWIO_BIMC_S_SYS_ARB_CONFIGURATION_INFO_0_ADDR A:0x451020
y.create.l HWIO_BIMC_S_SYS_ARB_CONFIGURATION_INFO_1_ADDR A:0x451030
y.create.l HWIO_BIMC_S_SYS_ARB_CLOCK_CTRL_ADDR A:0x451200
y.create.l HWIO_BIMC_S_SYS_ARB_MODE_ADDR A:0x451210
y.create.l HWIO_BIMC_S_DEFAULT_ARB_COMPONENT_INFO_ADDR A:0x459000
y.create.l HWIO_BIMC_S_DEFAULT_ARB_CONFIGURATION_INFO_0_ADDR A:0x459020
y.create.l HWIO_BIMC_S_DEFAULT_ARB_CONFIGURATION_INFO_1_ADDR A:0x459030
y.create.l HWIO_BIMC_S_DEFAULT_ARB_CLOCK_CTRL_ADDR A:0x459200
y.create.l HWIO_BIMC_S_DEFAULT_ARB_MODE_ADDR A:0x459210
y.create.l HWIO_BIMC_S_DDR0_SCMO_COMPONENT_INFO_ADDR A:0x448000
y.create.l HWIO_BIMC_S_DDR0_SCMO_HW_INFO_ADDR A:0x448010
y.create.l HWIO_BIMC_S_DDR0_SCMO_CONFIGURATION_INFO_0_ADDR A:0x448020
y.create.l HWIO_BIMC_S_DDR0_SCMO_CONFIGURATION_INFO_1_ADDR A:0x448030
y.create.l HWIO_BIMC_S_DDR0_SCMO_CONFIGURATION_INFO_2_ADDR A:0x448040
y.create.l HWIO_BIMC_S_DDR0_SCMO_CONFIGURATION_INFO_3_ADDR A:0x448050
y.create.l HWIO_BIMC_S_DDR0_SCMO_CONFIGURATION_INFO_4_ADDR A:0x448060
y.create.l HWIO_BIMC_S_DDR0_SCMO_CONFIGURATION_INFO_5_ADDR A:0x448070
y.create.l HWIO_BIMC_S_DDR0_SCMO_CONFIGURATION_INFO_6_ADDR A:0x448080
y.create.l HWIO_BIMC_S_DDR0_SCMO_INTERRUPT_STATUS_ADDR A:0x448100
y.create.l HWIO_BIMC_S_DDR0_SCMO_INTERRUPT_CLEAR_ADDR A:0x448108
y.create.l HWIO_BIMC_S_DDR0_SCMO_INTERRUPT_ENABLE_ADDR A:0x44810c
y.create.l HWIO_BIMC_S_DDR0_SCMO_ESYN_ADDR_ADDR A:0x448120
y.create.l HWIO_BIMC_S_DDR0_SCMO_ESYN_APACKET_0_ADDR A:0x448128
y.create.l HWIO_BIMC_S_DDR0_SCMO_ESYN_APACKET_1_ADDR A:0x44812c
y.create.l HWIO_BIMC_S_DDR0_SCMO_ESYN_APACKET_2_ADDR A:0x448130
y.create.l HWIO_BIMC_S_DDR0_SCMO_CLOCK_CTRL_ADDR A:0x448200
y.create.l HWIO_BIMC_S_DDR0_SCMO_SLV_INTERLEAVE_CFG_ADDR A:0x448400
y.create.l HWIO_BIMC_S_DDR0_SCMO_ADDR_BASE_CS0_ADDR A:0x448410
y.create.l HWIO_BIMC_S_DDR0_SCMO_ADDR_BASE_CS1_ADDR A:0x448414
y.create.l HWIO_BIMC_S_DDR0_SCMO_ADDR_MAP_CS0_ADDR A:0x448420
y.create.l HWIO_BIMC_S_DDR0_SCMO_ADDR_MAP_CS1_ADDR A:0x448424
y.create.l HWIO_BIMC_S_DDR0_SCMO_ADDR_MASK_CS0_ADDR A:0x448430
y.create.l HWIO_BIMC_S_DDR0_SCMO_ADDR_MASK_CS1_ADDR A:0x448434
y.create.l HWIO_BIMC_S_DDR0_SCMO_SLV_STATUS_ADDR A:0x448450
y.create.l HWIO_BIMC_S_DDR0_SCMO_GLOBAL_MON_CFG_ADDR A:0x448460
y.create.l HWIO_BIMC_S_DDR0_SCMO_CMD_BUF_CFG_ADDR A:0x448500
y.create.l HWIO_BIMC_S_DDR0_SCMO_CMD_BUF_STATUS_ADDR A:0x448520
y.create.l HWIO_BIMC_S_DDR0_SCMO_RCH_SELECT_ADDR A:0x448540
y.create.l HWIO_BIMC_S_DDR0_SCMO_RCH_BKPR_CFG_ADDR A:0x448544
y.create.l HWIO_BIMC_S_DDR0_SCMO_RCH_STATUS_ADDR A:0x448560
y.create.l HWIO_BIMC_S_DDR0_SCMO_WCH_BUF_CFG_ADDR A:0x448580
y.create.l HWIO_BIMC_S_DDR0_SCMO_WCH_STATUS_ADDR A:0x4485a0
y.create.l HWIO_BIMC_S_DDR0_SCMO_FLUSH_CFG_ADDR A:0x4485c0
y.create.l HWIO_BIMC_S_DDR0_SCMO_FLUSH_CMD_ADDR A:0x4485c4
y.create.l HWIO_BIMC_S_DDR0_SCMO_CMD_OPT_CFG0_ADDR A:0x448700
y.create.l HWIO_BIMC_S_DDR0_SCMO_CMD_OPT_CFG1_ADDR A:0x448704
y.create.l HWIO_BIMC_S_DDR0_SCMO_CMD_OPT_CFG2_ADDR A:0x448708
y.create.l HWIO_BIMC_S_DDR0_SCMO_CMD_OPT_CFG3_ADDR A:0x44870c
y.create.l HWIO_BIMC_S_DDR0_SCMO_CMD_OPT_CFG4_ADDR A:0x448710
y.create.l HWIO_BIMC_S_DDR0_SCMO_FSP_STATUS_ADDR A:0x448a40
y.create.l HWIO_BIMC_S_DDR0_XPU_SCR_ADDR A:0x44a000
y.create.l HWIO_BIMC_S_DDR0_XPU_SWDR_ADDR A:0x44a004
y.create.l HWIO_BIMC_S_DDR0_XPU_PRTN_RACR_SSHADOW_ADDR A:0x44a008
y.create.l HWIO_BIMC_S_DDR0_XPU_PRTN_WACR_SSHADOW_ADDR A:0x44a00c
y.create.l HWIO_BIMC_S_DDR0_XPU_PRTN_START_SSHADOW0_ADDR A:0x44a010
y.create.l HWIO_BIMC_S_DDR0_XPU_PRTN_END_SSHADOW0_ADDR A:0x44a018
y.create.l HWIO_BIMC_S_DDR0_XPU_SEAR0_ADDR A:0x44a040
y.create.l HWIO_BIMC_S_DDR0_XPU_SESR_ADDR A:0x44a048
y.create.l HWIO_BIMC_S_DDR0_XPU_SESRRESTORE_ADDR A:0x44a04c
y.create.l HWIO_BIMC_S_DDR0_XPU_SESYNR0_ADDR A:0x44a050
y.create.l HWIO_BIMC_S_DDR0_XPU_SESYNR1_ADDR A:0x44a054
y.create.l HWIO_BIMC_S_DDR0_XPU_SESYNR2_ADDR A:0x44a058
y.create.l HWIO_BIMC_S_DDR0_XPU_MCR_ADDR A:0x44a100
y.create.l HWIO_BIMC_S_DDR0_XPU_MEAR0_ADDR A:0x44a140
y.create.l HWIO_BIMC_S_DDR0_XPU_MESR_ADDR A:0x44a148
y.create.l HWIO_BIMC_S_DDR0_XPU_MESRRESTORE_ADDR A:0x44a14c
y.create.l HWIO_BIMC_S_DDR0_XPU_MESYNR0_ADDR A:0x44a150
y.create.l HWIO_BIMC_S_DDR0_XPU_MESYNR1_ADDR A:0x44a154
y.create.l HWIO_BIMC_S_DDR0_XPU_MESYNR2_ADDR A:0x44a158
y.create.l HWIO_BIMC_S_DDR0_XPU_CR_ADDR A:0x44a080
y.create.l HWIO_BIMC_S_DDR0_XPU_PRTN_RACR_SHADOW_ADDR A:0x44a088
y.create.l HWIO_BIMC_S_DDR0_XPU_PRTN_WACR_SHADOW_ADDR A:0x44a08c
y.create.l HWIO_BIMC_S_DDR0_XPU_PRTN_START_SHADOW0_ADDR A:0x44a090
y.create.l HWIO_BIMC_S_DDR0_XPU_PRTN_END_SHADOW0_ADDR A:0x44a098
y.create.l HWIO_BIMC_S_DDR0_XPU_RPU_ACR0_ADDR A:0x44a0a0
y.create.l HWIO_BIMC_S_DDR0_XPU_EAR0_ADDR A:0x44a0c0
y.create.l HWIO_BIMC_S_DDR0_XPU_ESR_ADDR A:0x44a0c8
y.create.l HWIO_BIMC_S_DDR0_XPU_ESRRESTORE_ADDR A:0x44a0cc
y.create.l HWIO_BIMC_S_DDR0_XPU_ESYNR0_ADDR A:0x44a0d0
y.create.l HWIO_BIMC_S_DDR0_XPU_ESYNR1_ADDR A:0x44a0d4
y.create.l HWIO_BIMC_S_DDR0_XPU_ESYNR2_ADDR A:0x44a0d8
y.create.l HWIO_BIMC_S_DDR0_XPU_UMR_RACR_ADDR A:0x44a0e0
y.create.l HWIO_BIMC_S_DDR0_XPU_UMR_WACR_ADDR A:0x44a0e4
y.create.l HWIO_BIMC_S_DDR0_XPU_UMR_CNTL_ADDR A:0x44a0f0
y.create.l HWIO_BIMC_S_DDR0_XPU_IDR0_ADDR A:0x44a074
y.create.l HWIO_BIMC_S_DDR0_XPU_IDR1_ADDR A:0x44a078
y.create.l HWIO_BIMC_S_DDR0_XPU_REV_ADDR A:0x44a07c
y.create.l HWIO_BIMC_S_DDR0_XPU_PRT0_RACR0_ADDR A:0x44a200
y.create.l HWIO_BIMC_S_DDR0_XPU_PRT1_RACR0_ADDR A:0x44a280
y.create.l HWIO_BIMC_S_DDR0_XPU_PRT2_RACR0_ADDR A:0x44a300
y.create.l HWIO_BIMC_S_DDR0_XPU_PRT3_RACR0_ADDR A:0x44a380
y.create.l HWIO_BIMC_S_DDR0_XPU_PRT4_RACR0_ADDR A:0x44a400
y.create.l HWIO_BIMC_S_DDR0_XPU_PRT5_RACR0_ADDR A:0x44a480
y.create.l HWIO_BIMC_S_DDR0_XPU_PRT6_RACR0_ADDR A:0x44a500
y.create.l HWIO_BIMC_S_DDR0_XPU_PRT7_RACR0_ADDR A:0x44a580
y.create.l HWIO_BIMC_S_DDR0_XPU_PRT8_RACR0_ADDR A:0x44a600
y.create.l HWIO_BIMC_S_DDR0_XPU_PRT9_RACR0_ADDR A:0x44a680
y.create.l HWIO_BIMC_S_DDR0_XPU_PRT0_WACR0_ADDR A:0x44a220
y.create.l HWIO_BIMC_S_DDR0_XPU_PRT1_WACR0_ADDR A:0x44a2a0
y.create.l HWIO_BIMC_S_DDR0_XPU_PRT2_WACR0_ADDR A:0x44a320
y.create.l HWIO_BIMC_S_DDR0_XPU_PRT3_WACR0_ADDR A:0x44a3a0
y.create.l HWIO_BIMC_S_DDR0_XPU_PRT4_WACR0_ADDR A:0x44a420
y.create.l HWIO_BIMC_S_DDR0_XPU_PRT5_WACR0_ADDR A:0x44a4a0
y.create.l HWIO_BIMC_S_DDR0_XPU_PRT6_WACR0_ADDR A:0x44a520
y.create.l HWIO_BIMC_S_DDR0_XPU_PRT7_WACR0_ADDR A:0x44a5a0
y.create.l HWIO_BIMC_S_DDR0_XPU_PRT8_WACR0_ADDR A:0x44a620
y.create.l HWIO_BIMC_S_DDR0_XPU_PRT9_WACR0_ADDR A:0x44a6a0
y.create.l HWIO_BIMC_S_DDR0_XPU_PRT0_START0_ADDR A:0x44a240
y.create.l HWIO_BIMC_S_DDR0_XPU_PRT1_START0_ADDR A:0x44a2c0
y.create.l HWIO_BIMC_S_DDR0_XPU_PRT2_START0_ADDR A:0x44a340
y.create.l HWIO_BIMC_S_DDR0_XPU_PRT3_START0_ADDR A:0x44a3c0
y.create.l HWIO_BIMC_S_DDR0_XPU_PRT4_START0_ADDR A:0x44a440
y.create.l HWIO_BIMC_S_DDR0_XPU_PRT5_START0_ADDR A:0x44a4c0
y.create.l HWIO_BIMC_S_DDR0_XPU_PRT6_START0_ADDR A:0x44a540
y.create.l HWIO_BIMC_S_DDR0_XPU_PRT7_START0_ADDR A:0x44a5c0
y.create.l HWIO_BIMC_S_DDR0_XPU_PRT8_START0_ADDR A:0x44a640
y.create.l HWIO_BIMC_S_DDR0_XPU_PRT9_START0_ADDR A:0x44a6c0
y.create.l HWIO_BIMC_S_DDR0_XPU_PRT0_END0_ADDR A:0x44a248
y.create.l HWIO_BIMC_S_DDR0_XPU_PRT1_END0_ADDR A:0x44a2c8
y.create.l HWIO_BIMC_S_DDR0_XPU_PRT2_END0_ADDR A:0x44a348
y.create.l HWIO_BIMC_S_DDR0_XPU_PRT3_END0_ADDR A:0x44a3c8
y.create.l HWIO_BIMC_S_DDR0_XPU_PRT4_END0_ADDR A:0x44a448
y.create.l HWIO_BIMC_S_DDR0_XPU_PRT5_END0_ADDR A:0x44a4c8
y.create.l HWIO_BIMC_S_DDR0_XPU_PRT6_END0_ADDR A:0x44a548
y.create.l HWIO_BIMC_S_DDR0_XPU_PRT7_END0_ADDR A:0x44a5c8
y.create.l HWIO_BIMC_S_DDR0_XPU_PRT8_END0_ADDR A:0x44a648
y.create.l HWIO_BIMC_S_DDR0_XPU_PRT9_END0_ADDR A:0x44a6c8
y.create.l HWIO_BIMC_S_DDR0_XPU_PRT0_SCR_ADDR A:0x44a250
y.create.l HWIO_BIMC_S_DDR0_XPU_PRT1_SCR_ADDR A:0x44a2d0
y.create.l HWIO_BIMC_S_DDR0_XPU_PRT2_SCR_ADDR A:0x44a350
y.create.l HWIO_BIMC_S_DDR0_XPU_PRT3_SCR_ADDR A:0x44a3d0
y.create.l HWIO_BIMC_S_DDR0_XPU_PRT4_SCR_ADDR A:0x44a450
y.create.l HWIO_BIMC_S_DDR0_XPU_PRT5_SCR_ADDR A:0x44a4d0
y.create.l HWIO_BIMC_S_DDR0_XPU_PRT6_SCR_ADDR A:0x44a550
y.create.l HWIO_BIMC_S_DDR0_XPU_PRT7_SCR_ADDR A:0x44a5d0
y.create.l HWIO_BIMC_S_DDR0_XPU_PRT8_SCR_ADDR A:0x44a650
y.create.l HWIO_BIMC_S_DDR0_XPU_PRT9_SCR_ADDR A:0x44a6d0
y.create.l HWIO_BIMC_S_DDR0_XPU_PRT0_MCR_ADDR A:0x44a254
y.create.l HWIO_BIMC_S_DDR0_XPU_PRT1_MCR_ADDR A:0x44a2d4
y.create.l HWIO_BIMC_S_DDR0_XPU_PRT2_MCR_ADDR A:0x44a354
y.create.l HWIO_BIMC_S_DDR0_XPU_PRT3_MCR_ADDR A:0x44a3d4
y.create.l HWIO_BIMC_S_DDR0_XPU_PRT4_MCR_ADDR A:0x44a454
y.create.l HWIO_BIMC_S_DDR0_XPU_PRT5_MCR_ADDR A:0x44a4d4
y.create.l HWIO_BIMC_S_DDR0_XPU_PRT6_MCR_ADDR A:0x44a554
y.create.l HWIO_BIMC_S_DDR0_XPU_PRT7_MCR_ADDR A:0x44a5d4
y.create.l HWIO_BIMC_S_DDR0_XPU_PRT8_MCR_ADDR A:0x44a654
y.create.l HWIO_BIMC_S_DDR0_XPU_PRT9_MCR_ADDR A:0x44a6d4
y.create.l HWIO_BIMC_S_DDR0_XPU_PRT0_CNTL0_ADDR A:0x44a258
y.create.l HWIO_BIMC_S_DDR0_XPU_PRT1_CNTL0_ADDR A:0x44a2d8
y.create.l HWIO_BIMC_S_DDR0_XPU_PRT2_CNTL0_ADDR A:0x44a358
y.create.l HWIO_BIMC_S_DDR0_XPU_PRT3_CNTL0_ADDR A:0x44a3d8
y.create.l HWIO_BIMC_S_DDR0_XPU_PRT4_CNTL0_ADDR A:0x44a458
y.create.l HWIO_BIMC_S_DDR0_XPU_PRT5_CNTL0_ADDR A:0x44a4d8
y.create.l HWIO_BIMC_S_DDR0_XPU_PRT6_CNTL0_ADDR A:0x44a558
y.create.l HWIO_BIMC_S_DDR0_XPU_PRT7_CNTL0_ADDR A:0x44a5d8
y.create.l HWIO_BIMC_S_DDR0_XPU_PRT8_CNTL0_ADDR A:0x44a658
y.create.l HWIO_BIMC_S_DDR0_XPU_PRT9_CNTL0_ADDR A:0x44a6d8
y.create.l HWIO_BIMC_S_DDR0_XPU_PRT0_CNTL1_ADDR A:0x44a25c
y.create.l HWIO_BIMC_S_DDR0_XPU_PRT1_CNTL1_ADDR A:0x44a2dc
y.create.l HWIO_BIMC_S_DDR0_XPU_PRT2_CNTL1_ADDR A:0x44a35c
y.create.l HWIO_BIMC_S_DDR0_XPU_PRT3_CNTL1_ADDR A:0x44a3dc
y.create.l HWIO_BIMC_S_DDR0_XPU_PRT4_CNTL1_ADDR A:0x44a45c
y.create.l HWIO_BIMC_S_DDR0_XPU_PRT5_CNTL1_ADDR A:0x44a4dc
y.create.l HWIO_BIMC_S_DDR0_XPU_PRT6_CNTL1_ADDR A:0x44a55c
y.create.l HWIO_BIMC_S_DDR0_XPU_PRT7_CNTL1_ADDR A:0x44a5dc
y.create.l HWIO_BIMC_S_DDR0_XPU_PRT8_CNTL1_ADDR A:0x44a65c
y.create.l HWIO_BIMC_S_DDR0_XPU_PRT9_CNTL1_ADDR A:0x44a6dc
y.create.l HWIO_BIMC_S_DDR0_XPU_AMT_RACR_ADDR A:0x44a0e8
y.create.l HWIO_BIMC_S_DDR0_XPU_AMT_WACR_ADDR A:0x44a0ec
y.create.l HWIO_BIMC_S_DDR0_XPU_AMTR0_ADDR A:0x44ae80
y.create.l HWIO_BIMC_S_DDR0_XPU_AMTR1_ADDR A:0x44ae84
y.create.l HWIO_BIMC_S_DDR0_XPU_AMTR2_ADDR A:0x44ae88
y.create.l HWIO_BIMC_S_DDR0_XPU_AMTR3_ADDR A:0x44ae8c
y.create.l HWIO_BIMC_S_DDR0_XPU_AMTR4_ADDR A:0x44ae90
y.create.l HWIO_BIMC_S_DDR0_XPU_AMTR5_ADDR A:0x44ae94
y.create.l HWIO_BIMC_S_DDR0_XPU_AMTR6_ADDR A:0x44ae98
y.create.l HWIO_BIMC_S_DDR0_XPU_AMTR7_ADDR A:0x44ae9c
y.create.l HWIO_BIMC_S_DDR0_XPU_AMTR8_ADDR A:0x44aea0
y.create.l HWIO_BIMC_S_DDR0_XPU_AMTR9_ADDR A:0x44aea4
y.create.l HWIO_BIMC_S_DDR0_DPE_HW_INFO_ADDR A:0x44c000
y.create.l HWIO_BIMC_S_DDR0_DPE_CONFIG_0_ADDR A:0x44c010
y.create.l HWIO_BIMC_S_DDR0_DPE_CONFIG_1_ADDR A:0x44c014
y.create.l HWIO_BIMC_S_DDR0_DPE_CONFIG_2_ADDR A:0x44c018
y.create.l HWIO_BIMC_S_DDR0_DPE_CONFIG_3_ADDR A:0x44c01c
y.create.l HWIO_BIMC_S_DDR0_DPE_CONFIG_4_ADDR A:0x44c020
y.create.l HWIO_BIMC_S_DDR0_DPE_CONFIG_5_ADDR A:0x44c024
y.create.l HWIO_BIMC_S_DDR0_DPE_CONFIG_6_ADDR A:0x44c028
y.create.l HWIO_BIMC_S_DDR0_DPE_CONFIG_7_ADDR A:0x44c02c
y.create.l HWIO_BIMC_S_DDR0_DPE_CONFIG_DQ_MAP_ADDR A:0x44c038
y.create.l HWIO_BIMC_S_DDR0_DPE_ODT_CONFIG_0_ADDR A:0x44c040
y.create.l HWIO_BIMC_S_DDR0_DPE_ODT_CONFIG_1_ADDR A:0x44c044
y.create.l HWIO_BIMC_S_DDR0_DPE_CA_TRAIN_PRE_CS_ADDR A:0x44c050
y.create.l HWIO_BIMC_S_DDR0_DPE_CA_TRAIN_CS_ADDR A:0x44c054
y.create.l HWIO_BIMC_S_DDR0_DPE_CA_TRAIN_POST_CS_ADDR A:0x44c058
y.create.l HWIO_BIMC_S_DDR0_DPE_RCW_CTRL_ADDR A:0x44c060
y.create.l HWIO_BIMC_S_DDR0_DPE_PWR_CTRL_0_ADDR A:0x44c068
y.create.l HWIO_BIMC_S_DDR0_DPE_OPT_CTRL_0_ADDR A:0x44c078
y.create.l HWIO_BIMC_S_DDR0_DPE_OPT_CTRL_1_ADDR A:0x44c07c
y.create.l HWIO_BIMC_S_DDR0_DPE_DRAM_STATUS_0_ADDR A:0x44c08c
y.create.l HWIO_BIMC_S_DDR0_DPE_MEMC_STATUS_0_ADDR A:0x44c09c
y.create.l HWIO_BIMC_S_DDR0_DPE_MEMC_STATUS_1_ADDR A:0x44c0a0
y.create.l HWIO_BIMC_S_DDR0_DPE_MEMC_STATUS_2_ADDR A:0x44c0a4
y.create.l HWIO_BIMC_S_DDR0_DPE_INTERRUPT_ENABLE_ADDR A:0x44c0b4
y.create.l HWIO_BIMC_S_DDR0_DPE_INTERRUPT_STATUS_ADDR A:0x44c0b8
y.create.l HWIO_BIMC_S_DDR0_DPE_INTERRUPT_CLR_ADDR A:0x44c0bc
y.create.l HWIO_BIMC_S_DDR0_DPE_INTERRUPT_SET_ADDR A:0x44c0c0
y.create.l HWIO_BIMC_S_DDR0_DPE_ELEVATE_PRI_RD_ADDR A:0x44c0d0
y.create.l HWIO_BIMC_S_DDR0_DPE_ELEVATE_PRI_WR_ADDR A:0x44c0d4
y.create.l HWIO_BIMC_S_DDR0_DPE_TIMER_0_ADDR A:0x44c0e4
y.create.l HWIO_BIMC_S_DDR0_DPE_TIMER_1_ADDR A:0x44c0e8
y.create.l HWIO_BIMC_S_DDR0_DPE_TIMER_2_ADDR A:0x44c0ec
y.create.l HWIO_BIMC_S_DDR0_DPE_TIMER_3_ADDR A:0x44c0f0
y.create.l HWIO_BIMC_S_DDR0_DPE_MRW_BEFORE_FREQ_SWITCH_0_ADDR A:0x44c114
y.create.l HWIO_BIMC_S_DDR0_DPE_MRW_BEFORE_FREQ_SWITCH_1_ADDR A:0x44c118
y.create.l HWIO_BIMC_S_DDR0_DPE_MRW_BEFORE_FREQ_SWITCH_2_ADDR A:0x44c11c
y.create.l HWIO_BIMC_S_DDR0_DPE_MRW_BEFORE_FREQ_SWITCH_3_ADDR A:0x44c120
y.create.l HWIO_BIMC_S_DDR0_DPE_MRW_AFTER_FREQ_SWITCH_0_ADDR A:0x44c124
y.create.l HWIO_BIMC_S_DDR0_DPE_MRW_AFTER_FREQ_SWITCH_1_ADDR A:0x44c128
y.create.l HWIO_BIMC_S_DDR0_DPE_MRW_AFTER_FREQ_SWITCH_2_ADDR A:0x44c12c
y.create.l HWIO_BIMC_S_DDR0_DPE_MRW_AFTER_FREQ_SWITCH_3_ADDR A:0x44c130
y.create.l HWIO_BIMC_S_DDR0_DPE_MRW_FREQ_SWITCH_ADDR A:0x44c134
y.create.l HWIO_BIMC_S_DDR0_DPE_DRAM_TIMING_0_ADDR A:0x44c144
y.create.l HWIO_BIMC_S_DDR0_DPE_DRAM_TIMING_1_ADDR A:0x44c148
y.create.l HWIO_BIMC_S_DDR0_DPE_DRAM_TIMING_2_ADDR A:0x44c14c
y.create.l HWIO_BIMC_S_DDR0_DPE_DRAM_TIMING_3_ADDR A:0x44c150
y.create.l HWIO_BIMC_S_DDR0_DPE_DRAM_TIMING_4_ADDR A:0x44c154
y.create.l HWIO_BIMC_S_DDR0_DPE_DRAM_TIMING_5_ADDR A:0x44c158
y.create.l HWIO_BIMC_S_DDR0_DPE_DRAM_TIMING_6_ADDR A:0x44c15c
y.create.l HWIO_BIMC_S_DDR0_DPE_DRAM_TIMING_7_ADDR A:0x44c160
y.create.l HWIO_BIMC_S_DDR0_DPE_DRAM_TIMING_8_ADDR A:0x44c164
y.create.l HWIO_BIMC_S_DDR0_DPE_DRAM_TIMING_9_ADDR A:0x44c168
y.create.l HWIO_BIMC_S_DDR0_DPE_DRAM_TIMING_10_ADDR A:0x44c16c
y.create.l HWIO_BIMC_S_DDR0_DPE_DRAM_TIMING_11_ADDR A:0x44c170
y.create.l HWIO_BIMC_S_DDR0_DPE_DRAM_TIMING_12_ADDR A:0x44c174
y.create.l HWIO_BIMC_S_DDR0_DPE_DRAM_TIMING_13_ADDR A:0x44c178
y.create.l HWIO_BIMC_S_DDR0_DPE_DRAM_TIMING_14_ADDR A:0x44c17c
y.create.l HWIO_BIMC_S_DDR0_DPE_DRAM_TIMING_15_ADDR A:0x44c180
y.create.l HWIO_BIMC_S_DDR0_DPE_DRAM_TIMING_16_ADDR A:0x44c184
y.create.l HWIO_BIMC_S_DDR0_DPE_DRAM_TIMING_17_ADDR A:0x44c188
y.create.l HWIO_BIMC_S_DDR0_DPE_DRAM_TIMING_18_ADDR A:0x44c18c
y.create.l HWIO_BIMC_S_DDR0_DPE_DRAM_TIMING_19_ADDR A:0x44c190
y.create.l HWIO_BIMC_S_DDR0_DPE_DRAM_TIMING_20_ADDR A:0x44c194
y.create.l HWIO_BIMC_S_DDR0_DPE_DRAM_TIMING_21_ADDR A:0x44c198
y.create.l HWIO_BIMC_S_DDR0_DPE_DRAM_TIMING_22_ADDR A:0x44c19c
y.create.l HWIO_BIMC_S_DDR0_DPE_DRAM_TIMING_23_ADDR A:0x44c1a0
y.create.l HWIO_BIMC_S_DDR0_DPE_DRAM_TIMING_0_ACT_ADDR A:0x44c1a4
y.create.l HWIO_BIMC_S_DDR0_DPE_DRAM_TIMING_1_ACT_ADDR A:0x44c1a8
y.create.l HWIO_BIMC_S_DDR0_DPE_DRAM_TIMING_2_ACT_ADDR A:0x44c1ac
y.create.l HWIO_BIMC_S_DDR0_DPE_DRAM_TIMING_3_ACT_ADDR A:0x44c1b0
y.create.l HWIO_BIMC_S_DDR0_DPE_DRAM_TIMING_4_ACT_ADDR A:0x44c1b4
y.create.l HWIO_BIMC_S_DDR0_DPE_DRAM_TIMING_5_ACT_ADDR A:0x44c1b8
y.create.l HWIO_BIMC_S_DDR0_DPE_DRAM_TIMING_6_ACT_ADDR A:0x44c1bc
y.create.l HWIO_BIMC_S_DDR0_DPE_DRAM_TIMING_7_ACT_ADDR A:0x44c1c0
y.create.l HWIO_BIMC_S_DDR0_DPE_DRAM_TIMING_8_ACT_ADDR A:0x44c1c4
y.create.l HWIO_BIMC_S_DDR0_DPE_DRAM_TIMING_9_ACT_ADDR A:0x44c1c8
y.create.l HWIO_BIMC_S_DDR0_DPE_DRAM_TIMING_10_ACT_ADDR A:0x44c1cc
y.create.l HWIO_BIMC_S_DDR0_DPE_DRAM_TIMING_11_ACT_ADDR A:0x44c1d0
y.create.l HWIO_BIMC_S_DDR0_DPE_DRAM_TIMING_12_ACT_ADDR A:0x44c1d4
y.create.l HWIO_BIMC_S_DDR0_DPE_DRAM_TIMING_13_ACT_ADDR A:0x44c1d8
y.create.l HWIO_BIMC_S_DDR0_DPE_DRAM_TIMING_14_ACT_ADDR A:0x44c1dc
y.create.l HWIO_BIMC_S_DDR0_DPE_DRAM_TIMING_15_ACT_ADDR A:0x44c1e0
y.create.l HWIO_BIMC_S_DDR0_DPE_DRAM_TIMING_16_ACT_ADDR A:0x44c1e4
y.create.l HWIO_BIMC_S_DDR0_DPE_DRAM_TIMING_17_ACT_ADDR A:0x44c1e8
y.create.l HWIO_BIMC_S_DDR0_DPE_DRAM_TIMING_18_ACT_ADDR A:0x44c1ec
y.create.l HWIO_BIMC_S_DDR0_DPE_DRAM_TIMING_19_ACT_ADDR A:0x44c1f0
y.create.l HWIO_BIMC_S_DDR0_DPE_DRAM_TIMING_20_ACT_ADDR A:0x44c1f4
y.create.l HWIO_BIMC_S_DDR0_DPE_DRAM_TIMING_21_ACT_ADDR A:0x44c1f8
y.create.l HWIO_BIMC_S_DDR0_DPE_DRAM_TIMING_22_ACT_ADDR A:0x44c1fc
y.create.l HWIO_BIMC_S_DDR0_DPE_DRAM_TIMING_23_ACT_ADDR A:0x44c200
y.create.l HWIO_BIMC_S_DDR0_DPE_TESTBUS_CTRL_ADDR A:0x44c204
y.create.l HWIO_BIMC_S_DDR0_DPE_SPARE_REG_ADDR A:0x44c214
y.create.l HWIO_BIMC_S_DDR0_DPE_SPARE_REG_ACT_ADDR A:0x44c224
y.create.l HWIO_BIMC_S_DDR0_DPE_DQCAL_RDATA_RANK1_U_ADDR A:0x44c240
y.create.l HWIO_BIMC_S_DDR0_DPE_DQCAL_RDATA_RANK1_L_ADDR A:0x44c244
y.create.l HWIO_BIMC_S_DDR0_DPE_DQCAL_RDATA_RANK0_U_ADDR A:0x44c248
y.create.l HWIO_BIMC_S_DDR0_DPE_DQCAL_RDATA_RANK0_L_ADDR A:0x44c24c
y.create.l HWIO_BIMC_S_DDR0_DPE_DQCAL_STATUS0_RANK1_ADDR A:0x44c260
y.create.l HWIO_BIMC_S_DDR0_DPE_DQCAL_STATUS1_RANK1_ADDR A:0x44c264
y.create.l HWIO_BIMC_S_DDR0_DPE_DQCAL_STATUS2_RANK1_ADDR A:0x44c268
y.create.l HWIO_BIMC_S_DDR0_DPE_DQCAL_STATUS0_RANK0_ADDR A:0x44c280
y.create.l HWIO_BIMC_S_DDR0_DPE_DQCAL_STATUS1_RANK0_ADDR A:0x44c284
y.create.l HWIO_BIMC_S_DDR0_DPE_DQCAL_STATUS2_RANK0_ADDR A:0x44c288
y.create.l HWIO_BIMC_S_DDR0_DPE_CGC_CTRL_ADDR A:0x44c2fc
y.create.l HWIO_BIMC_S_DDR0_DPE_PMON_EN_ADDR A:0x44c300
y.create.l HWIO_BIMC_S_DDR0_DPE_PMON_CFG_ADDR A:0x44c304
y.create.l HWIO_BIMC_S_DDR0_DPE_PMON_CMD_QUEUED_0_ADDR A:0x44c310
y.create.l HWIO_BIMC_S_DDR0_DPE_PMON_CMD_QUEUED_1_ADDR A:0x44c314
y.create.l HWIO_BIMC_S_DDR0_DPE_PMON_CMD_QUEUED_2_ADDR A:0x44c318
y.create.l HWIO_BIMC_S_DDR0_DPE_PMON_CMD_QUEUED_3_ADDR A:0x44c31c
y.create.l HWIO_BIMC_S_DDR0_DPE_PMON_CMD_EXEC_0_ADDR A:0x44c320
y.create.l HWIO_BIMC_S_DDR0_DPE_PMON_CMD_EXEC_1_ADDR A:0x44c324
y.create.l HWIO_BIMC_S_DDR0_DPE_PMON_CMD_EXEC_2_ADDR A:0x44c328
y.create.l HWIO_BIMC_S_DDR0_DPE_PMON_CMD_EXEC_3_ADDR A:0x44c32c
y.create.l HWIO_BIMC_S_DDR0_DPE_PMON_CMD_FLTR_0_ADDR A:0x44c330
y.create.l HWIO_BIMC_S_DDR0_DPE_PMON_CMD_FLTR_1_ADDR A:0x44c334
y.create.l HWIO_BIMC_S_DDR0_DPE_PMON_CMD_FLTR_2_ADDR A:0x44c338
y.create.l HWIO_BIMC_S_DDR0_DPE_PMON_CMD_FLTR_3_ADDR A:0x44c33c
y.create.l HWIO_BIMC_S_DDR0_DPE_PMON_ADDR_FLTR_0_ADDR A:0x44c340
y.create.l HWIO_BIMC_S_DDR0_DPE_PMON_ADDR_FLTR_1_ADDR A:0x44c344
y.create.l HWIO_BIMC_S_DDR0_DPE_PMON_ADDR_FLTR_2_ADDR A:0x44c348
y.create.l HWIO_BIMC_S_DDR0_DPE_PMON_ADDR_FLTR_3_ADDR A:0x44c34c
y.create.l HWIO_BIMC_S_DDR0_DPE_PMON_MID_FLTR_0_ADDR A:0x44c350
y.create.l HWIO_BIMC_S_DDR0_DPE_PMON_MID_FLTR_1_ADDR A:0x44c354
y.create.l HWIO_BIMC_S_DDR0_DPE_PMON_LAT_LIM_0_ADDR A:0x44c360
y.create.l HWIO_BIMC_S_DDR0_DPE_PMON_LAT_LIM_1_ADDR A:0x44c364
y.create.l HWIO_BIMC_S_DDR0_DPE_PMON_LAT_LIM_2_ADDR A:0x44c368
y.create.l HWIO_BIMC_S_DDR0_DPE_PMON_LAT_LIM_3_ADDR A:0x44c36c
y.create.l HWIO_BIMC_S_DDR0_DPE_PMON_PRI_FLTR_0_ADDR A:0x44c370
y.create.l HWIO_BIMC_S_DDR0_DPE_PMON_PRI_FLTR_1_ADDR A:0x44c374
y.create.l HWIO_BIMC_S_DDR0_DPE_PMON_PRI_FLTR_2_ADDR A:0x44c378
y.create.l HWIO_BIMC_S_DDR0_DPE_PMON_PRI_FLTR_3_ADDR A:0x44c37c
y.create.l HWIO_BIMC_S_DDR0_DPE_PMON_CMDQ_0_ADDR A:0x44c380
y.create.l HWIO_BIMC_S_DDR0_DPE_PMON_CMDQ_1_ADDR A:0x44c384
y.create.l HWIO_BIMC_S_DDR0_DPE_PMON_WRBUF_0_ADDR A:0x44c388
y.create.l HWIO_BIMC_S_DDR0_DPE_PMON_WRBUF_1_ADDR A:0x44c38c
y.create.l HWIO_BIMC_S_DDR0_DPE_PMON_DDR_CMD_0_ADDR A:0x44c390
y.create.l HWIO_BIMC_S_DDR0_DPE_PMON_DDR_CMD_1_ADDR A:0x44c394
y.create.l HWIO_BIMC_S_DDR0_DPE_PMON_DDR_CMD_2_ADDR A:0x44c398
y.create.l HWIO_BIMC_S_DDR0_DPE_PMON_DDR_CMD_3_ADDR A:0x44c39c
y.create.l HWIO_BIMC_S_DDR0_DPE_PMON_DDR_DATA_0_ADDR A:0x44c3a0
y.create.l HWIO_BIMC_S_DDR0_DPE_PMON_DDR_DATA_1_ADDR A:0x44c3a4
y.create.l HWIO_BIMC_S_DDR0_DPE_PMON_RANK_STATE_0_ADDR A:0x44c3b0
y.create.l HWIO_BIMC_S_DDR0_DPE_PMON_RANK_STATE_1_ADDR A:0x44c3b4
y.create.l HWIO_BIMC_S_DDR0_DPE_PMON_RANK_STATE_2_ADDR A:0x44c3b8
y.create.l HWIO_BIMC_S_DDR0_DPE_PMON_RANK_STATE_3_ADDR A:0x44c3bc
y.create.l HWIO_BIMC_S_DDR0_DPE_PMON_SHKE_0_ADDR A:0x44c3c0
y.create.l HWIO_BIMC_S_DDR0_DPE_PMON_SHKE_1_ADDR A:0x44c3c4
y.create.l HWIO_BIMC_S_DDR0_DPE_PMON_SHKE_2_ADDR A:0x44c3c8
y.create.l HWIO_BIMC_S_DDR0_DPE_PMON_SHKE_3_ADDR A:0x44c3cc
y.create.l HWIO_BIMC_S_DDR0_DPE_PMON_SHKE_4_ADDR A:0x44c3d0
y.create.l HWIO_BIMC_S_DDR0_DPE_PMON_SHKE_5_ADDR A:0x44c3d4
y.create.l HWIO_BIMC_S_DDR0_DPE_PMON_SHKE_6_ADDR A:0x44c3d8
y.create.l HWIO_BIMC_S_DDR0_DPE_PMON_SHKE_7_ADDR A:0x44c3dc
y.create.l HWIO_BIMC_S_DDR0_SHKE_HW_INFO_ADDR A:0x44d000
y.create.l HWIO_BIMC_S_DDR0_SHKE_CONFIG_ADDR A:0x44d004
y.create.l HWIO_BIMC_S_DDR0_SHKE_CGC_CNTL_ADDR A:0x44d010
y.create.l HWIO_BIMC_S_DDR0_SHKE_DRAM_MANUAL_0_ADDR A:0x44d020
y.create.l HWIO_BIMC_S_DDR0_SHKE_DRAM_MANUAL_1_ADDR A:0x44d024
y.create.l HWIO_BIMC_S_DDR0_SHKE_MREG_ADDR_WDATA_CNTL_ADDR A:0x44d030
y.create.l HWIO_BIMC_S_DDR0_SHKE_MREG_RDATA_RANK1_U_ADDR A:0x44d050
y.create.l HWIO_BIMC_S_DDR0_SHKE_MREG_RDATA_RANK1_L_ADDR A:0x44d054
y.create.l HWIO_BIMC_S_DDR0_SHKE_MREG_RDATA_RANK0_U_ADDR A:0x44d060
y.create.l HWIO_BIMC_S_DDR0_SHKE_MREG_RDATA_RANK0_L_ADDR A:0x44d064
y.create.l HWIO_BIMC_S_DDR0_SHKE_MREG_RDATA_STATUS_ADDR A:0x44d070
y.create.l HWIO_BIMC_S_DDR0_SHKE_DRAM_STATUS_ADDR A:0x44d074
y.create.l HWIO_BIMC_S_DDR0_SHKE_DRAM_DEBUG_CMD_0_ADDR A:0x44d080
y.create.l HWIO_BIMC_S_DDR0_SHKE_DRAM_DEBUG_CMD_1_ADDR A:0x44d084
y.create.l HWIO_BIMC_S_DDR0_SHKE_DRAM_DEBUG_CMD_2_ADDR A:0x44d088
y.create.l HWIO_BIMC_S_DDR0_SHKE_PERIODIC_MRR_ADDR A:0x44d0a0
y.create.l HWIO_BIMC_S_DDR0_SHKE_PERIODIC_MRR_RDATA_RANK1_U_ADDR A:0x44d0b0
y.create.l HWIO_BIMC_S_DDR0_SHKE_PERIODIC_MRR_RDATA_RANK1_L_ADDR A:0x44d0b4
y.create.l HWIO_BIMC_S_DDR0_SHKE_PERIODIC_MRR_RDATA_RANK0_U_ADDR A:0x44d0b8
y.create.l HWIO_BIMC_S_DDR0_SHKE_PERIODIC_MRR_RDATA_RANK0_L_ADDR A:0x44d0bc
y.create.l HWIO_BIMC_S_DDR0_SHKE_PERIODIC_ZQCAL_ADDR A:0x44d0d0
y.create.l HWIO_BIMC_S_DDR0_SHKE_AUTO_REFRESH_CNTL_ADDR A:0x44d0f0
y.create.l HWIO_BIMC_S_DDR0_SHKE_SELF_REFRESH_CNTL_ADDR A:0x44d0f4
y.create.l HWIO_BIMC_S_DDR0_SHKE_AUTO_REFRESH_CNTL_1_ADDR A:0x44d100
y.create.l HWIO_BIMC_S_DDR0_SHKE_AUTO_REFRESH_CNTL_2_ADDR A:0x44d104
y.create.l HWIO_BIMC_S_DDR0_SHKE_TESTBUS_CNTL_ADDR A:0x44d114
y.create.l HWIO_BIMC_S_DDR0_SHKE_SPARE_REG_ADDR A:0x44d130
y.create.l HWIO_BLSP1_BLSP_BAM_BAM_CTRL_ADDR A:0x7884000
y.create.l HWIO_BLSP1_BLSP_BAM_BAM_TIMER_ADDR A:0x7884040
y.create.l HWIO_BLSP1_BLSP_BAM_BAM_TIMER_CTRL_ADDR A:0x7884044
y.create.l HWIO_BLSP1_BLSP_BAM_BAM_DESC_CNT_TRSHLD_ADDR A:0x7884008
y.create.l HWIO_BLSP1_BLSP_BAM_BAM_IRQ_STTS_ADDR A:0x7884014
y.create.l HWIO_BLSP1_BLSP_BAM_BAM_IRQ_CLR_ADDR A:0x7884018
y.create.l HWIO_BLSP1_BLSP_BAM_BAM_IRQ_EN_ADDR A:0x788401c
y.create.l HWIO_BLSP1_BLSP_BAM_BAM_CNFG_BITS_ADDR A:0x788407c
y.create.l HWIO_BLSP1_BLSP_BAM_BAM_REVISION_ADDR A:0x7885000
y.create.l HWIO_BLSP1_BLSP_BAM_BAM_SW_VERSION_ADDR A:0x7885004
y.create.l HWIO_BLSP1_BLSP_BAM_BAM_NUM_PIPES_ADDR A:0x7885008
y.create.l HWIO_BLSP1_BLSP_BAM_BAM_TEST_BUS_SEL_ADDR A:0x7885010
y.create.l HWIO_BLSP1_BLSP_BAM_BAM_TEST_BUS_REG_ADDR A:0x7885014
y.create.l HWIO_BLSP1_BLSP_BAM_BAM_AHB_MASTER_ERR_CTRLS_ADDR A:0x7885024
y.create.l HWIO_BLSP1_BLSP_BAM_BAM_AHB_MASTER_ERR_ADDR_ADDR A:0x7885028
y.create.l HWIO_BLSP1_BLSP_BAM_BAM_AHB_MASTER_ERR_DATA_ADDR A:0x788502c
y.create.l HWIO_BLSP1_BLSP_BAM_BAM_AHB_MASTER_ERR_ADDR_LSB_ADDR A:0x7885100
y.create.l HWIO_BLSP1_BLSP_BAM_BAM_AHB_MASTER_ERR_ADDR_MSB_ADDR A:0x7885104
y.create.l HWIO_BLSP1_BLSP_BAM_BAM_TRUST_REG_ADDR A:0x7886000
y.create.l HWIO_BLSP1_BLSP_BAM_BAM_P_TRUST_REG0_ADDR A:0x7886020
y.create.l HWIO_BLSP1_BLSP_BAM_BAM_P_TRUST_REG1_ADDR A:0x7886024
y.create.l HWIO_BLSP1_BLSP_BAM_BAM_P_TRUST_REG2_ADDR A:0x7886028
y.create.l HWIO_BLSP1_BLSP_BAM_BAM_P_TRUST_REG3_ADDR A:0x788602c
y.create.l HWIO_BLSP1_BLSP_BAM_BAM_P_TRUST_REG4_ADDR A:0x7886030
y.create.l HWIO_BLSP1_BLSP_BAM_BAM_P_TRUST_REG5_ADDR A:0x7886034
y.create.l HWIO_BLSP1_BLSP_BAM_BAM_P_TRUST_REG6_ADDR A:0x7886038
y.create.l HWIO_BLSP1_BLSP_BAM_BAM_P_TRUST_REG7_ADDR A:0x788603c
y.create.l HWIO_BLSP1_BLSP_BAM_BAM_P_TRUST_REG8_ADDR A:0x7886040
y.create.l HWIO_BLSP1_BLSP_BAM_BAM_P_TRUST_REG9_ADDR A:0x7886044
y.create.l HWIO_BLSP1_BLSP_BAM_BAM_IRQ_SRCS_EE0_ADDR A:0x7887000
y.create.l HWIO_BLSP1_BLSP_BAM_BAM_IRQ_SRCS_EE1_ADDR A:0x7888000
y.create.l HWIO_BLSP1_BLSP_BAM_BAM_IRQ_SRCS_EE2_ADDR A:0x7889000
y.create.l HWIO_BLSP1_BLSP_BAM_BAM_IRQ_SRCS_EE3_ADDR A:0x788a000
y.create.l HWIO_BLSP1_BLSP_BAM_BAM_IRQ_SRCS_EE4_ADDR A:0x788b000
y.create.l HWIO_BLSP1_BLSP_BAM_BAM_IRQ_SRCS_EE5_ADDR A:0x788c000
y.create.l HWIO_BLSP1_BLSP_BAM_BAM_IRQ_SRCS_EE6_ADDR A:0x788d000
y.create.l HWIO_BLSP1_BLSP_BAM_BAM_IRQ_SRCS_EE7_ADDR A:0x788e000
y.create.l HWIO_BLSP1_BLSP_BAM_BAM_IRQ_SRCS_MSK_EE0_ADDR A:0x7887004
y.create.l HWIO_BLSP1_BLSP_BAM_BAM_IRQ_SRCS_MSK_EE1_ADDR A:0x7888004
y.create.l HWIO_BLSP1_BLSP_BAM_BAM_IRQ_SRCS_MSK_EE2_ADDR A:0x7889004
y.create.l HWIO_BLSP1_BLSP_BAM_BAM_IRQ_SRCS_MSK_EE3_ADDR A:0x788a004
y.create.l HWIO_BLSP1_BLSP_BAM_BAM_IRQ_SRCS_MSK_EE4_ADDR A:0x788b004
y.create.l HWIO_BLSP1_BLSP_BAM_BAM_IRQ_SRCS_MSK_EE5_ADDR A:0x788c004
y.create.l HWIO_BLSP1_BLSP_BAM_BAM_IRQ_SRCS_MSK_EE6_ADDR A:0x788d004
y.create.l HWIO_BLSP1_BLSP_BAM_BAM_IRQ_SRCS_MSK_EE7_ADDR A:0x788e004
y.create.l HWIO_BLSP1_BLSP_BAM_BAM_IRQ_SRCS_UNMASKED_EE0_ADDR A:0x7887008
y.create.l HWIO_BLSP1_BLSP_BAM_BAM_IRQ_SRCS_UNMASKED_EE1_ADDR A:0x7888008
y.create.l HWIO_BLSP1_BLSP_BAM_BAM_IRQ_SRCS_UNMASKED_EE2_ADDR A:0x7889008
y.create.l HWIO_BLSP1_BLSP_BAM_BAM_IRQ_SRCS_UNMASKED_EE3_ADDR A:0x788a008
y.create.l HWIO_BLSP1_BLSP_BAM_BAM_IRQ_SRCS_UNMASKED_EE4_ADDR A:0x788b008
y.create.l HWIO_BLSP1_BLSP_BAM_BAM_IRQ_SRCS_UNMASKED_EE5_ADDR A:0x788c008
y.create.l HWIO_BLSP1_BLSP_BAM_BAM_IRQ_SRCS_UNMASKED_EE6_ADDR A:0x788d008
y.create.l HWIO_BLSP1_BLSP_BAM_BAM_IRQ_SRCS_UNMASKED_EE7_ADDR A:0x788e008
y.create.l HWIO_BLSP1_BLSP_BAM_BAM_PIPE_ATTR_EE0_ADDR A:0x788700c
y.create.l HWIO_BLSP1_BLSP_BAM_BAM_PIPE_ATTR_EE1_ADDR A:0x788800c
y.create.l HWIO_BLSP1_BLSP_BAM_BAM_PIPE_ATTR_EE2_ADDR A:0x788900c
y.create.l HWIO_BLSP1_BLSP_BAM_BAM_PIPE_ATTR_EE3_ADDR A:0x788a00c
y.create.l HWIO_BLSP1_BLSP_BAM_BAM_PIPE_ATTR_EE4_ADDR A:0x788b00c
y.create.l HWIO_BLSP1_BLSP_BAM_BAM_PIPE_ATTR_EE5_ADDR A:0x788c00c
y.create.l HWIO_BLSP1_BLSP_BAM_BAM_PIPE_ATTR_EE6_ADDR A:0x788d00c
y.create.l HWIO_BLSP1_BLSP_BAM_BAM_PIPE_ATTR_EE7_ADDR A:0x788e00c
y.create.l HWIO_BLSP1_BLSP_BAM_BAM_IRQ_SRCS_ADDR A:0x7887010
y.create.l HWIO_BLSP1_BLSP_BAM_BAM_IRQ_SRCS_MSK_ADDR A:0x7887014
y.create.l HWIO_BLSP1_BLSP_BAM_BAM_IRQ_SRCS_UNMASKED_ADDR A:0x7887018
y.create.l HWIO_BLSP1_BLSP_BAM_BAM_P_CTRL0_ADDR A:0x7897000
y.create.l HWIO_BLSP1_BLSP_BAM_BAM_P_CTRL1_ADDR A:0x7898000
y.create.l HWIO_BLSP1_BLSP_BAM_BAM_P_CTRL2_ADDR A:0x7899000
y.create.l HWIO_BLSP1_BLSP_BAM_BAM_P_CTRL3_ADDR A:0x789a000
y.create.l HWIO_BLSP1_BLSP_BAM_BAM_P_CTRL4_ADDR A:0x789b000
y.create.l HWIO_BLSP1_BLSP_BAM_BAM_P_CTRL5_ADDR A:0x789c000
y.create.l HWIO_BLSP1_BLSP_BAM_BAM_P_CTRL6_ADDR A:0x789d000
y.create.l HWIO_BLSP1_BLSP_BAM_BAM_P_CTRL7_ADDR A:0x789e000
y.create.l HWIO_BLSP1_BLSP_BAM_BAM_P_CTRL8_ADDR A:0x789f000
y.create.l HWIO_BLSP1_BLSP_BAM_BAM_P_CTRL9_ADDR A:0x78a0000
y.create.l HWIO_BLSP1_BLSP_BAM_BAM_P_RST0_ADDR A:0x7897004
y.create.l HWIO_BLSP1_BLSP_BAM_BAM_P_RST1_ADDR A:0x7898004
y.create.l HWIO_BLSP1_BLSP_BAM_BAM_P_RST2_ADDR A:0x7899004
y.create.l HWIO_BLSP1_BLSP_BAM_BAM_P_RST3_ADDR A:0x789a004
y.create.l HWIO_BLSP1_BLSP_BAM_BAM_P_RST4_ADDR A:0x789b004
y.create.l HWIO_BLSP1_BLSP_BAM_BAM_P_RST5_ADDR A:0x789c004
y.create.l HWIO_BLSP1_BLSP_BAM_BAM_P_RST6_ADDR A:0x789d004
y.create.l HWIO_BLSP1_BLSP_BAM_BAM_P_RST7_ADDR A:0x789e004
y.create.l HWIO_BLSP1_BLSP_BAM_BAM_P_RST8_ADDR A:0x789f004
y.create.l HWIO_BLSP1_BLSP_BAM_BAM_P_RST9_ADDR A:0x78a0004
y.create.l HWIO_BLSP1_BLSP_BAM_BAM_P_HALT0_ADDR A:0x7897008
y.create.l HWIO_BLSP1_BLSP_BAM_BAM_P_HALT1_ADDR A:0x7898008
y.create.l HWIO_BLSP1_BLSP_BAM_BAM_P_HALT2_ADDR A:0x7899008
y.create.l HWIO_BLSP1_BLSP_BAM_BAM_P_HALT3_ADDR A:0x789a008
y.create.l HWIO_BLSP1_BLSP_BAM_BAM_P_HALT4_ADDR A:0x789b008
y.create.l HWIO_BLSP1_BLSP_BAM_BAM_P_HALT5_ADDR A:0x789c008
y.create.l HWIO_BLSP1_BLSP_BAM_BAM_P_HALT6_ADDR A:0x789d008
y.create.l HWIO_BLSP1_BLSP_BAM_BAM_P_HALT7_ADDR A:0x789e008
y.create.l HWIO_BLSP1_BLSP_BAM_BAM_P_HALT8_ADDR A:0x789f008
y.create.l HWIO_BLSP1_BLSP_BAM_BAM_P_HALT9_ADDR A:0x78a0008
y.create.l HWIO_BLSP1_BLSP_BAM_BAM_P_IRQ_STTS0_ADDR A:0x7897010
y.create.l HWIO_BLSP1_BLSP_BAM_BAM_P_IRQ_STTS1_ADDR A:0x7898010
y.create.l HWIO_BLSP1_BLSP_BAM_BAM_P_IRQ_STTS2_ADDR A:0x7899010
y.create.l HWIO_BLSP1_BLSP_BAM_BAM_P_IRQ_STTS3_ADDR A:0x789a010
y.create.l HWIO_BLSP1_BLSP_BAM_BAM_P_IRQ_STTS4_ADDR A:0x789b010
y.create.l HWIO_BLSP1_BLSP_BAM_BAM_P_IRQ_STTS5_ADDR A:0x789c010
y.create.l HWIO_BLSP1_BLSP_BAM_BAM_P_IRQ_STTS6_ADDR A:0x789d010
y.create.l HWIO_BLSP1_BLSP_BAM_BAM_P_IRQ_STTS7_ADDR A:0x789e010
y.create.l HWIO_BLSP1_BLSP_BAM_BAM_P_IRQ_STTS8_ADDR A:0x789f010
y.create.l HWIO_BLSP1_BLSP_BAM_BAM_P_IRQ_STTS9_ADDR A:0x78a0010
y.create.l HWIO_BLSP1_BLSP_BAM_BAM_P_IRQ_CLR0_ADDR A:0x7897014
y.create.l HWIO_BLSP1_BLSP_BAM_BAM_P_IRQ_CLR1_ADDR A:0x7898014
y.create.l HWIO_BLSP1_BLSP_BAM_BAM_P_IRQ_CLR2_ADDR A:0x7899014
y.create.l HWIO_BLSP1_BLSP_BAM_BAM_P_IRQ_CLR3_ADDR A:0x789a014
y.create.l HWIO_BLSP1_BLSP_BAM_BAM_P_IRQ_CLR4_ADDR A:0x789b014
y.create.l HWIO_BLSP1_BLSP_BAM_BAM_P_IRQ_CLR5_ADDR A:0x789c014
y.create.l HWIO_BLSP1_BLSP_BAM_BAM_P_IRQ_CLR6_ADDR A:0x789d014
y.create.l HWIO_BLSP1_BLSP_BAM_BAM_P_IRQ_CLR7_ADDR A:0x789e014
y.create.l HWIO_BLSP1_BLSP_BAM_BAM_P_IRQ_CLR8_ADDR A:0x789f014
y.create.l HWIO_BLSP1_BLSP_BAM_BAM_P_IRQ_CLR9_ADDR A:0x78a0014
y.create.l HWIO_BLSP1_BLSP_BAM_BAM_P_IRQ_EN0_ADDR A:0x7897018
y.create.l HWIO_BLSP1_BLSP_BAM_BAM_P_IRQ_EN1_ADDR A:0x7898018
y.create.l HWIO_BLSP1_BLSP_BAM_BAM_P_IRQ_EN2_ADDR A:0x7899018
y.create.l HWIO_BLSP1_BLSP_BAM_BAM_P_IRQ_EN3_ADDR A:0x789a018
y.create.l HWIO_BLSP1_BLSP_BAM_BAM_P_IRQ_EN4_ADDR A:0x789b018
y.create.l HWIO_BLSP1_BLSP_BAM_BAM_P_IRQ_EN5_ADDR A:0x789c018
y.create.l HWIO_BLSP1_BLSP_BAM_BAM_P_IRQ_EN6_ADDR A:0x789d018
y.create.l HWIO_BLSP1_BLSP_BAM_BAM_P_IRQ_EN7_ADDR A:0x789e018
y.create.l HWIO_BLSP1_BLSP_BAM_BAM_P_IRQ_EN8_ADDR A:0x789f018
y.create.l HWIO_BLSP1_BLSP_BAM_BAM_P_IRQ_EN9_ADDR A:0x78a0018
y.create.l HWIO_BLSP1_BLSP_BAM_BAM_P_TIMER0_ADDR A:0x789701c
y.create.l HWIO_BLSP1_BLSP_BAM_BAM_P_TIMER1_ADDR A:0x789801c
y.create.l HWIO_BLSP1_BLSP_BAM_BAM_P_TIMER2_ADDR A:0x789901c
y.create.l HWIO_BLSP1_BLSP_BAM_BAM_P_TIMER3_ADDR A:0x789a01c
y.create.l HWIO_BLSP1_BLSP_BAM_BAM_P_TIMER4_ADDR A:0x789b01c
y.create.l HWIO_BLSP1_BLSP_BAM_BAM_P_TIMER5_ADDR A:0x789c01c
y.create.l HWIO_BLSP1_BLSP_BAM_BAM_P_TIMER6_ADDR A:0x789d01c
y.create.l HWIO_BLSP1_BLSP_BAM_BAM_P_TIMER7_ADDR A:0x789e01c
y.create.l HWIO_BLSP1_BLSP_BAM_BAM_P_TIMER8_ADDR A:0x789f01c
y.create.l HWIO_BLSP1_BLSP_BAM_BAM_P_TIMER9_ADDR A:0x78a001c
y.create.l HWIO_BLSP1_BLSP_BAM_BAM_P_TIMER_CTRL0_ADDR A:0x7897020
y.create.l HWIO_BLSP1_BLSP_BAM_BAM_P_TIMER_CTRL1_ADDR A:0x7898020
y.create.l HWIO_BLSP1_BLSP_BAM_BAM_P_TIMER_CTRL2_ADDR A:0x7899020
y.create.l HWIO_BLSP1_BLSP_BAM_BAM_P_TIMER_CTRL3_ADDR A:0x789a020
y.create.l HWIO_BLSP1_BLSP_BAM_BAM_P_TIMER_CTRL4_ADDR A:0x789b020
y.create.l HWIO_BLSP1_BLSP_BAM_BAM_P_TIMER_CTRL5_ADDR A:0x789c020
y.create.l HWIO_BLSP1_BLSP_BAM_BAM_P_TIMER_CTRL6_ADDR A:0x789d020
y.create.l HWIO_BLSP1_BLSP_BAM_BAM_P_TIMER_CTRL7_ADDR A:0x789e020
y.create.l HWIO_BLSP1_BLSP_BAM_BAM_P_TIMER_CTRL8_ADDR A:0x789f020
y.create.l HWIO_BLSP1_BLSP_BAM_BAM_P_TIMER_CTRL9_ADDR A:0x78a0020
y.create.l HWIO_BLSP1_BLSP_BAM_BAM_P_PRDCR_SDBND0_ADDR A:0x7897024
y.create.l HWIO_BLSP1_BLSP_BAM_BAM_P_PRDCR_SDBND1_ADDR A:0x7898024
y.create.l HWIO_BLSP1_BLSP_BAM_BAM_P_PRDCR_SDBND2_ADDR A:0x7899024
y.create.l HWIO_BLSP1_BLSP_BAM_BAM_P_PRDCR_SDBND3_ADDR A:0x789a024
y.create.l HWIO_BLSP1_BLSP_BAM_BAM_P_PRDCR_SDBND4_ADDR A:0x789b024
y.create.l HWIO_BLSP1_BLSP_BAM_BAM_P_PRDCR_SDBND5_ADDR A:0x789c024
y.create.l HWIO_BLSP1_BLSP_BAM_BAM_P_PRDCR_SDBND6_ADDR A:0x789d024
y.create.l HWIO_BLSP1_BLSP_BAM_BAM_P_PRDCR_SDBND7_ADDR A:0x789e024
y.create.l HWIO_BLSP1_BLSP_BAM_BAM_P_PRDCR_SDBND8_ADDR A:0x789f024
y.create.l HWIO_BLSP1_BLSP_BAM_BAM_P_PRDCR_SDBND9_ADDR A:0x78a0024
y.create.l HWIO_BLSP1_BLSP_BAM_BAM_P_CNSMR_SDBND0_ADDR A:0x7897028
y.create.l HWIO_BLSP1_BLSP_BAM_BAM_P_CNSMR_SDBND1_ADDR A:0x7898028
y.create.l HWIO_BLSP1_BLSP_BAM_BAM_P_CNSMR_SDBND2_ADDR A:0x7899028
y.create.l HWIO_BLSP1_BLSP_BAM_BAM_P_CNSMR_SDBND3_ADDR A:0x789a028
y.create.l HWIO_BLSP1_BLSP_BAM_BAM_P_CNSMR_SDBND4_ADDR A:0x789b028
y.create.l HWIO_BLSP1_BLSP_BAM_BAM_P_CNSMR_SDBND5_ADDR A:0x789c028
y.create.l HWIO_BLSP1_BLSP_BAM_BAM_P_CNSMR_SDBND6_ADDR A:0x789d028
y.create.l HWIO_BLSP1_BLSP_BAM_BAM_P_CNSMR_SDBND7_ADDR A:0x789e028
y.create.l HWIO_BLSP1_BLSP_BAM_BAM_P_CNSMR_SDBND8_ADDR A:0x789f028
y.create.l HWIO_BLSP1_BLSP_BAM_BAM_P_CNSMR_SDBND9_ADDR A:0x78a0028
y.create.l HWIO_BLSP1_BLSP_BAM_BAM_P_SW_OFSTS0_ADDR A:0x7897800
y.create.l HWIO_BLSP1_BLSP_BAM_BAM_P_SW_OFSTS1_ADDR A:0x7898800
y.create.l HWIO_BLSP1_BLSP_BAM_BAM_P_SW_OFSTS2_ADDR A:0x7899800
y.create.l HWIO_BLSP1_BLSP_BAM_BAM_P_SW_OFSTS3_ADDR A:0x789a800
y.create.l HWIO_BLSP1_BLSP_BAM_BAM_P_SW_OFSTS4_ADDR A:0x789b800
y.create.l HWIO_BLSP1_BLSP_BAM_BAM_P_SW_OFSTS5_ADDR A:0x789c800
y.create.l HWIO_BLSP1_BLSP_BAM_BAM_P_SW_OFSTS6_ADDR A:0x789d800
y.create.l HWIO_BLSP1_BLSP_BAM_BAM_P_SW_OFSTS7_ADDR A:0x789e800
y.create.l HWIO_BLSP1_BLSP_BAM_BAM_P_SW_OFSTS8_ADDR A:0x789f800
y.create.l HWIO_BLSP1_BLSP_BAM_BAM_P_SW_OFSTS9_ADDR A:0x78a0800
y.create.l HWIO_BLSP1_BLSP_BAM_BAM_P_AU_PSM_CNTXT_1_0_ADDR A:0x7897804
y.create.l HWIO_BLSP1_BLSP_BAM_BAM_P_AU_PSM_CNTXT_1_1_ADDR A:0x7898804
y.create.l HWIO_BLSP1_BLSP_BAM_BAM_P_AU_PSM_CNTXT_1_2_ADDR A:0x7899804
y.create.l HWIO_BLSP1_BLSP_BAM_BAM_P_AU_PSM_CNTXT_1_3_ADDR A:0x789a804
y.create.l HWIO_BLSP1_BLSP_BAM_BAM_P_AU_PSM_CNTXT_1_4_ADDR A:0x789b804
y.create.l HWIO_BLSP1_BLSP_BAM_BAM_P_AU_PSM_CNTXT_1_5_ADDR A:0x789c804
y.create.l HWIO_BLSP1_BLSP_BAM_BAM_P_AU_PSM_CNTXT_1_6_ADDR A:0x789d804
y.create.l HWIO_BLSP1_BLSP_BAM_BAM_P_AU_PSM_CNTXT_1_7_ADDR A:0x789e804
y.create.l HWIO_BLSP1_BLSP_BAM_BAM_P_AU_PSM_CNTXT_1_8_ADDR A:0x789f804
y.create.l HWIO_BLSP1_BLSP_BAM_BAM_P_AU_PSM_CNTXT_1_9_ADDR A:0x78a0804
y.create.l HWIO_BLSP1_BLSP_BAM_BAM_P_PSM_CNTXT_2_0_ADDR A:0x7897808
y.create.l HWIO_BLSP1_BLSP_BAM_BAM_P_PSM_CNTXT_2_1_ADDR A:0x7898808
y.create.l HWIO_BLSP1_BLSP_BAM_BAM_P_PSM_CNTXT_2_2_ADDR A:0x7899808
y.create.l HWIO_BLSP1_BLSP_BAM_BAM_P_PSM_CNTXT_2_3_ADDR A:0x789a808
y.create.l HWIO_BLSP1_BLSP_BAM_BAM_P_PSM_CNTXT_2_4_ADDR A:0x789b808
y.create.l HWIO_BLSP1_BLSP_BAM_BAM_P_PSM_CNTXT_2_5_ADDR A:0x789c808
y.create.l HWIO_BLSP1_BLSP_BAM_BAM_P_PSM_CNTXT_2_6_ADDR A:0x789d808
y.create.l HWIO_BLSP1_BLSP_BAM_BAM_P_PSM_CNTXT_2_7_ADDR A:0x789e808
y.create.l HWIO_BLSP1_BLSP_BAM_BAM_P_PSM_CNTXT_2_8_ADDR A:0x789f808
y.create.l HWIO_BLSP1_BLSP_BAM_BAM_P_PSM_CNTXT_2_9_ADDR A:0x78a0808
y.create.l HWIO_BLSP1_BLSP_BAM_BAM_P_PSM_CNTXT_3_0_ADDR A:0x789780c
y.create.l HWIO_BLSP1_BLSP_BAM_BAM_P_PSM_CNTXT_3_1_ADDR A:0x789880c
y.create.l HWIO_BLSP1_BLSP_BAM_BAM_P_PSM_CNTXT_3_2_ADDR A:0x789980c
y.create.l HWIO_BLSP1_BLSP_BAM_BAM_P_PSM_CNTXT_3_3_ADDR A:0x789a80c
y.create.l HWIO_BLSP1_BLSP_BAM_BAM_P_PSM_CNTXT_3_4_ADDR A:0x789b80c
y.create.l HWIO_BLSP1_BLSP_BAM_BAM_P_PSM_CNTXT_3_5_ADDR A:0x789c80c
y.create.l HWIO_BLSP1_BLSP_BAM_BAM_P_PSM_CNTXT_3_6_ADDR A:0x789d80c
y.create.l HWIO_BLSP1_BLSP_BAM_BAM_P_PSM_CNTXT_3_7_ADDR A:0x789e80c
y.create.l HWIO_BLSP1_BLSP_BAM_BAM_P_PSM_CNTXT_3_8_ADDR A:0x789f80c
y.create.l HWIO_BLSP1_BLSP_BAM_BAM_P_PSM_CNTXT_3_9_ADDR A:0x78a080c
y.create.l HWIO_BLSP1_BLSP_BAM_BAM_P_PSM_CNTXT_4_0_ADDR A:0x7897810
y.create.l HWIO_BLSP1_BLSP_BAM_BAM_P_PSM_CNTXT_4_1_ADDR A:0x7898810
y.create.l HWIO_BLSP1_BLSP_BAM_BAM_P_PSM_CNTXT_4_2_ADDR A:0x7899810
y.create.l HWIO_BLSP1_BLSP_BAM_BAM_P_PSM_CNTXT_4_3_ADDR A:0x789a810
y.create.l HWIO_BLSP1_BLSP_BAM_BAM_P_PSM_CNTXT_4_4_ADDR A:0x789b810
y.create.l HWIO_BLSP1_BLSP_BAM_BAM_P_PSM_CNTXT_4_5_ADDR A:0x789c810
y.create.l HWIO_BLSP1_BLSP_BAM_BAM_P_PSM_CNTXT_4_6_ADDR A:0x789d810
y.create.l HWIO_BLSP1_BLSP_BAM_BAM_P_PSM_CNTXT_4_7_ADDR A:0x789e810
y.create.l HWIO_BLSP1_BLSP_BAM_BAM_P_PSM_CNTXT_4_8_ADDR A:0x789f810
y.create.l HWIO_BLSP1_BLSP_BAM_BAM_P_PSM_CNTXT_4_9_ADDR A:0x78a0810
y.create.l HWIO_BLSP1_BLSP_BAM_BAM_P_PSM_CNTXT_5_0_ADDR A:0x7897814
y.create.l HWIO_BLSP1_BLSP_BAM_BAM_P_PSM_CNTXT_5_1_ADDR A:0x7898814
y.create.l HWIO_BLSP1_BLSP_BAM_BAM_P_PSM_CNTXT_5_2_ADDR A:0x7899814
y.create.l HWIO_BLSP1_BLSP_BAM_BAM_P_PSM_CNTXT_5_3_ADDR A:0x789a814
y.create.l HWIO_BLSP1_BLSP_BAM_BAM_P_PSM_CNTXT_5_4_ADDR A:0x789b814
y.create.l HWIO_BLSP1_BLSP_BAM_BAM_P_PSM_CNTXT_5_5_ADDR A:0x789c814
y.create.l HWIO_BLSP1_BLSP_BAM_BAM_P_PSM_CNTXT_5_6_ADDR A:0x789d814
y.create.l HWIO_BLSP1_BLSP_BAM_BAM_P_PSM_CNTXT_5_7_ADDR A:0x789e814
y.create.l HWIO_BLSP1_BLSP_BAM_BAM_P_PSM_CNTXT_5_8_ADDR A:0x789f814
y.create.l HWIO_BLSP1_BLSP_BAM_BAM_P_PSM_CNTXT_5_9_ADDR A:0x78a0814
y.create.l HWIO_BLSP1_BLSP_BAM_BAM_P_EVNT_REG0_ADDR A:0x7897818
y.create.l HWIO_BLSP1_BLSP_BAM_BAM_P_EVNT_REG1_ADDR A:0x7898818
y.create.l HWIO_BLSP1_BLSP_BAM_BAM_P_EVNT_REG2_ADDR A:0x7899818
y.create.l HWIO_BLSP1_BLSP_BAM_BAM_P_EVNT_REG3_ADDR A:0x789a818
y.create.l HWIO_BLSP1_BLSP_BAM_BAM_P_EVNT_REG4_ADDR A:0x789b818
y.create.l HWIO_BLSP1_BLSP_BAM_BAM_P_EVNT_REG5_ADDR A:0x789c818
y.create.l HWIO_BLSP1_BLSP_BAM_BAM_P_EVNT_REG6_ADDR A:0x789d818
y.create.l HWIO_BLSP1_BLSP_BAM_BAM_P_EVNT_REG7_ADDR A:0x789e818
y.create.l HWIO_BLSP1_BLSP_BAM_BAM_P_EVNT_REG8_ADDR A:0x789f818
y.create.l HWIO_BLSP1_BLSP_BAM_BAM_P_EVNT_REG9_ADDR A:0x78a0818
y.create.l HWIO_BLSP1_BLSP_BAM_BAM_P_DESC_FIFO_ADDR0_ADDR A:0x789781c
y.create.l HWIO_BLSP1_BLSP_BAM_BAM_P_DESC_FIFO_ADDR1_ADDR A:0x789881c
y.create.l HWIO_BLSP1_BLSP_BAM_BAM_P_DESC_FIFO_ADDR2_ADDR A:0x789981c
y.create.l HWIO_BLSP1_BLSP_BAM_BAM_P_DESC_FIFO_ADDR3_ADDR A:0x789a81c
y.create.l HWIO_BLSP1_BLSP_BAM_BAM_P_DESC_FIFO_ADDR4_ADDR A:0x789b81c
y.create.l HWIO_BLSP1_BLSP_BAM_BAM_P_DESC_FIFO_ADDR5_ADDR A:0x789c81c
y.create.l HWIO_BLSP1_BLSP_BAM_BAM_P_DESC_FIFO_ADDR6_ADDR A:0x789d81c
y.create.l HWIO_BLSP1_BLSP_BAM_BAM_P_DESC_FIFO_ADDR7_ADDR A:0x789e81c
y.create.l HWIO_BLSP1_BLSP_BAM_BAM_P_DESC_FIFO_ADDR8_ADDR A:0x789f81c
y.create.l HWIO_BLSP1_BLSP_BAM_BAM_P_DESC_FIFO_ADDR9_ADDR A:0x78a081c
y.create.l HWIO_BLSP1_BLSP_BAM_BAM_P_FIFO_SIZES0_ADDR A:0x7897820
y.create.l HWIO_BLSP1_BLSP_BAM_BAM_P_FIFO_SIZES1_ADDR A:0x7898820
y.create.l HWIO_BLSP1_BLSP_BAM_BAM_P_FIFO_SIZES2_ADDR A:0x7899820
y.create.l HWIO_BLSP1_BLSP_BAM_BAM_P_FIFO_SIZES3_ADDR A:0x789a820
y.create.l HWIO_BLSP1_BLSP_BAM_BAM_P_FIFO_SIZES4_ADDR A:0x789b820
y.create.l HWIO_BLSP1_BLSP_BAM_BAM_P_FIFO_SIZES5_ADDR A:0x789c820
y.create.l HWIO_BLSP1_BLSP_BAM_BAM_P_FIFO_SIZES6_ADDR A:0x789d820
y.create.l HWIO_BLSP1_BLSP_BAM_BAM_P_FIFO_SIZES7_ADDR A:0x789e820
y.create.l HWIO_BLSP1_BLSP_BAM_BAM_P_FIFO_SIZES8_ADDR A:0x789f820
y.create.l HWIO_BLSP1_BLSP_BAM_BAM_P_FIFO_SIZES9_ADDR A:0x78a0820
y.create.l HWIO_BLSP1_BLSP_BAM_BAM_P_DATA_FIFO_ADDR0_ADDR A:0x7897824
y.create.l HWIO_BLSP1_BLSP_BAM_BAM_P_DATA_FIFO_ADDR1_ADDR A:0x7898824
y.create.l HWIO_BLSP1_BLSP_BAM_BAM_P_DATA_FIFO_ADDR2_ADDR A:0x7899824
y.create.l HWIO_BLSP1_BLSP_BAM_BAM_P_DATA_FIFO_ADDR3_ADDR A:0x789a824
y.create.l HWIO_BLSP1_BLSP_BAM_BAM_P_DATA_FIFO_ADDR4_ADDR A:0x789b824
y.create.l HWIO_BLSP1_BLSP_BAM_BAM_P_DATA_FIFO_ADDR5_ADDR A:0x789c824
y.create.l HWIO_BLSP1_BLSP_BAM_BAM_P_DATA_FIFO_ADDR6_ADDR A:0x789d824
y.create.l HWIO_BLSP1_BLSP_BAM_BAM_P_DATA_FIFO_ADDR7_ADDR A:0x789e824
y.create.l HWIO_BLSP1_BLSP_BAM_BAM_P_DATA_FIFO_ADDR8_ADDR A:0x789f824
y.create.l HWIO_BLSP1_BLSP_BAM_BAM_P_DATA_FIFO_ADDR9_ADDR A:0x78a0824
y.create.l HWIO_BLSP1_BLSP_BAM_BAM_P_EVNT_GEN_TRSHLD0_ADDR A:0x7897828
y.create.l HWIO_BLSP1_BLSP_BAM_BAM_P_EVNT_GEN_TRSHLD1_ADDR A:0x7898828
y.create.l HWIO_BLSP1_BLSP_BAM_BAM_P_EVNT_GEN_TRSHLD2_ADDR A:0x7899828
y.create.l HWIO_BLSP1_BLSP_BAM_BAM_P_EVNT_GEN_TRSHLD3_ADDR A:0x789a828
y.create.l HWIO_BLSP1_BLSP_BAM_BAM_P_EVNT_GEN_TRSHLD4_ADDR A:0x789b828
y.create.l HWIO_BLSP1_BLSP_BAM_BAM_P_EVNT_GEN_TRSHLD5_ADDR A:0x789c828
y.create.l HWIO_BLSP1_BLSP_BAM_BAM_P_EVNT_GEN_TRSHLD6_ADDR A:0x789d828
y.create.l HWIO_BLSP1_BLSP_BAM_BAM_P_EVNT_GEN_TRSHLD7_ADDR A:0x789e828
y.create.l HWIO_BLSP1_BLSP_BAM_BAM_P_EVNT_GEN_TRSHLD8_ADDR A:0x789f828
y.create.l HWIO_BLSP1_BLSP_BAM_BAM_P_EVNT_GEN_TRSHLD9_ADDR A:0x78a0828
y.create.l HWIO_BLSP1_BLSP_BAM_BAM_P_EVNT_DEST_ADDR0_ADDR A:0x789782c
y.create.l HWIO_BLSP1_BLSP_BAM_BAM_P_EVNT_DEST_ADDR1_ADDR A:0x789882c
y.create.l HWIO_BLSP1_BLSP_BAM_BAM_P_EVNT_DEST_ADDR2_ADDR A:0x789982c
y.create.l HWIO_BLSP1_BLSP_BAM_BAM_P_EVNT_DEST_ADDR3_ADDR A:0x789a82c
y.create.l HWIO_BLSP1_BLSP_BAM_BAM_P_EVNT_DEST_ADDR4_ADDR A:0x789b82c
y.create.l HWIO_BLSP1_BLSP_BAM_BAM_P_EVNT_DEST_ADDR5_ADDR A:0x789c82c
y.create.l HWIO_BLSP1_BLSP_BAM_BAM_P_EVNT_DEST_ADDR6_ADDR A:0x789d82c
y.create.l HWIO_BLSP1_BLSP_BAM_BAM_P_EVNT_DEST_ADDR7_ADDR A:0x789e82c
y.create.l HWIO_BLSP1_BLSP_BAM_BAM_P_EVNT_DEST_ADDR8_ADDR A:0x789f82c
y.create.l HWIO_BLSP1_BLSP_BAM_BAM_P_EVNT_DEST_ADDR9_ADDR A:0x78a082c
y.create.l HWIO_BLSP1_BLSP_BAM_BAM_P_DF_CNTXT_0_ADDR A:0x7897830
y.create.l HWIO_BLSP1_BLSP_BAM_BAM_P_DF_CNTXT_1_ADDR A:0x7898830
y.create.l HWIO_BLSP1_BLSP_BAM_BAM_P_DF_CNTXT_2_ADDR A:0x7899830
y.create.l HWIO_BLSP1_BLSP_BAM_BAM_P_DF_CNTXT_3_ADDR A:0x789a830
y.create.l HWIO_BLSP1_BLSP_BAM_BAM_P_DF_CNTXT_4_ADDR A:0x789b830
y.create.l HWIO_BLSP1_BLSP_BAM_BAM_P_DF_CNTXT_5_ADDR A:0x789c830
y.create.l HWIO_BLSP1_BLSP_BAM_BAM_P_DF_CNTXT_6_ADDR A:0x789d830
y.create.l HWIO_BLSP1_BLSP_BAM_BAM_P_DF_CNTXT_7_ADDR A:0x789e830
y.create.l HWIO_BLSP1_BLSP_BAM_BAM_P_DF_CNTXT_8_ADDR A:0x789f830
y.create.l HWIO_BLSP1_BLSP_BAM_BAM_P_DF_CNTXT_9_ADDR A:0x78a0830
y.create.l HWIO_BLSP1_BLSP_BAM_BAM_P_RETR_CNTXT_0_ADDR A:0x7897834
y.create.l HWIO_BLSP1_BLSP_BAM_BAM_P_RETR_CNTXT_1_ADDR A:0x7898834
y.create.l HWIO_BLSP1_BLSP_BAM_BAM_P_RETR_CNTXT_2_ADDR A:0x7899834
y.create.l HWIO_BLSP1_BLSP_BAM_BAM_P_RETR_CNTXT_3_ADDR A:0x789a834
y.create.l HWIO_BLSP1_BLSP_BAM_BAM_P_RETR_CNTXT_4_ADDR A:0x789b834
y.create.l HWIO_BLSP1_BLSP_BAM_BAM_P_RETR_CNTXT_5_ADDR A:0x789c834
y.create.l HWIO_BLSP1_BLSP_BAM_BAM_P_RETR_CNTXT_6_ADDR A:0x789d834
y.create.l HWIO_BLSP1_BLSP_BAM_BAM_P_RETR_CNTXT_7_ADDR A:0x789e834
y.create.l HWIO_BLSP1_BLSP_BAM_BAM_P_RETR_CNTXT_8_ADDR A:0x789f834
y.create.l HWIO_BLSP1_BLSP_BAM_BAM_P_RETR_CNTXT_9_ADDR A:0x78a0834
y.create.l HWIO_BLSP1_BLSP_BAM_BAM_P_SI_CNTXT_0_ADDR A:0x7897838
y.create.l HWIO_BLSP1_BLSP_BAM_BAM_P_SI_CNTXT_1_ADDR A:0x7898838
y.create.l HWIO_BLSP1_BLSP_BAM_BAM_P_SI_CNTXT_2_ADDR A:0x7899838
y.create.l HWIO_BLSP1_BLSP_BAM_BAM_P_SI_CNTXT_3_ADDR A:0x789a838
y.create.l HWIO_BLSP1_BLSP_BAM_BAM_P_SI_CNTXT_4_ADDR A:0x789b838
y.create.l HWIO_BLSP1_BLSP_BAM_BAM_P_SI_CNTXT_5_ADDR A:0x789c838
y.create.l HWIO_BLSP1_BLSP_BAM_BAM_P_SI_CNTXT_6_ADDR A:0x789d838
y.create.l HWIO_BLSP1_BLSP_BAM_BAM_P_SI_CNTXT_7_ADDR A:0x789e838
y.create.l HWIO_BLSP1_BLSP_BAM_BAM_P_SI_CNTXT_8_ADDR A:0x789f838
y.create.l HWIO_BLSP1_BLSP_BAM_BAM_P_SI_CNTXT_9_ADDR A:0x78a0838
y.create.l HWIO_BLSP1_BLSP_BAM_BAM_P_PSM_CNTXT_3_LSB0_ADDR A:0x7897900
y.create.l HWIO_BLSP1_BLSP_BAM_BAM_P_PSM_CNTXT_3_LSB1_ADDR A:0x7898900
y.create.l HWIO_BLSP1_BLSP_BAM_BAM_P_PSM_CNTXT_3_LSB2_ADDR A:0x7899900
y.create.l HWIO_BLSP1_BLSP_BAM_BAM_P_PSM_CNTXT_3_LSB3_ADDR A:0x789a900
y.create.l HWIO_BLSP1_BLSP_BAM_BAM_P_PSM_CNTXT_3_LSB4_ADDR A:0x789b900
y.create.l HWIO_BLSP1_BLSP_BAM_BAM_P_PSM_CNTXT_3_LSB5_ADDR A:0x789c900
y.create.l HWIO_BLSP1_BLSP_BAM_BAM_P_PSM_CNTXT_3_LSB6_ADDR A:0x789d900
y.create.l HWIO_BLSP1_BLSP_BAM_BAM_P_PSM_CNTXT_3_LSB7_ADDR A:0x789e900
y.create.l HWIO_BLSP1_BLSP_BAM_BAM_P_PSM_CNTXT_3_LSB8_ADDR A:0x789f900
y.create.l HWIO_BLSP1_BLSP_BAM_BAM_P_PSM_CNTXT_3_LSB9_ADDR A:0x78a0900
y.create.l HWIO_BLSP1_BLSP_BAM_BAM_P_PSM_CNTXT_3_MSB0_ADDR A:0x7897904
y.create.l HWIO_BLSP1_BLSP_BAM_BAM_P_PSM_CNTXT_3_MSB1_ADDR A:0x7898904
y.create.l HWIO_BLSP1_BLSP_BAM_BAM_P_PSM_CNTXT_3_MSB2_ADDR A:0x7899904
y.create.l HWIO_BLSP1_BLSP_BAM_BAM_P_PSM_CNTXT_3_MSB3_ADDR A:0x789a904
y.create.l HWIO_BLSP1_BLSP_BAM_BAM_P_PSM_CNTXT_3_MSB4_ADDR A:0x789b904
y.create.l HWIO_BLSP1_BLSP_BAM_BAM_P_PSM_CNTXT_3_MSB5_ADDR A:0x789c904
y.create.l HWIO_BLSP1_BLSP_BAM_BAM_P_PSM_CNTXT_3_MSB6_ADDR A:0x789d904
y.create.l HWIO_BLSP1_BLSP_BAM_BAM_P_PSM_CNTXT_3_MSB7_ADDR A:0x789e904
y.create.l HWIO_BLSP1_BLSP_BAM_BAM_P_PSM_CNTXT_3_MSB8_ADDR A:0x789f904
y.create.l HWIO_BLSP1_BLSP_BAM_BAM_P_PSM_CNTXT_3_MSB9_ADDR A:0x78a0904
y.create.l HWIO_BLSP1_BLSP_BAM_BAM_P_DESC_FIFO_ADDR_LSB0_ADDR A:0x7897910
y.create.l HWIO_BLSP1_BLSP_BAM_BAM_P_DESC_FIFO_ADDR_LSB1_ADDR A:0x7898910
y.create.l HWIO_BLSP1_BLSP_BAM_BAM_P_DESC_FIFO_ADDR_LSB2_ADDR A:0x7899910
y.create.l HWIO_BLSP1_BLSP_BAM_BAM_P_DESC_FIFO_ADDR_LSB3_ADDR A:0x789a910
y.create.l HWIO_BLSP1_BLSP_BAM_BAM_P_DESC_FIFO_ADDR_LSB4_ADDR A:0x789b910
y.create.l HWIO_BLSP1_BLSP_BAM_BAM_P_DESC_FIFO_ADDR_LSB5_ADDR A:0x789c910
y.create.l HWIO_BLSP1_BLSP_BAM_BAM_P_DESC_FIFO_ADDR_LSB6_ADDR A:0x789d910
y.create.l HWIO_BLSP1_BLSP_BAM_BAM_P_DESC_FIFO_ADDR_LSB7_ADDR A:0x789e910
y.create.l HWIO_BLSP1_BLSP_BAM_BAM_P_DESC_FIFO_ADDR_LSB8_ADDR A:0x789f910
y.create.l HWIO_BLSP1_BLSP_BAM_BAM_P_DESC_FIFO_ADDR_LSB9_ADDR A:0x78a0910
y.create.l HWIO_BLSP1_BLSP_BAM_BAM_P_DESC_FIFO_ADDR_MSB0_ADDR A:0x7897914
y.create.l HWIO_BLSP1_BLSP_BAM_BAM_P_DESC_FIFO_ADDR_MSB1_ADDR A:0x7898914
y.create.l HWIO_BLSP1_BLSP_BAM_BAM_P_DESC_FIFO_ADDR_MSB2_ADDR A:0x7899914
y.create.l HWIO_BLSP1_BLSP_BAM_BAM_P_DESC_FIFO_ADDR_MSB3_ADDR A:0x789a914
y.create.l HWIO_BLSP1_BLSP_BAM_BAM_P_DESC_FIFO_ADDR_MSB4_ADDR A:0x789b914
y.create.l HWIO_BLSP1_BLSP_BAM_BAM_P_DESC_FIFO_ADDR_MSB5_ADDR A:0x789c914
y.create.l HWIO_BLSP1_BLSP_BAM_BAM_P_DESC_FIFO_ADDR_MSB6_ADDR A:0x789d914
y.create.l HWIO_BLSP1_BLSP_BAM_BAM_P_DESC_FIFO_ADDR_MSB7_ADDR A:0x789e914
y.create.l HWIO_BLSP1_BLSP_BAM_BAM_P_DESC_FIFO_ADDR_MSB8_ADDR A:0x789f914
y.create.l HWIO_BLSP1_BLSP_BAM_BAM_P_DESC_FIFO_ADDR_MSB9_ADDR A:0x78a0914
y.create.l HWIO_BLSP1_BLSP_BAM_BAM_P_DATA_FIFO_ADDR_LSB0_ADDR A:0x7897920
y.create.l HWIO_BLSP1_BLSP_BAM_BAM_P_DATA_FIFO_ADDR_LSB1_ADDR A:0x7898920
y.create.l HWIO_BLSP1_BLSP_BAM_BAM_P_DATA_FIFO_ADDR_LSB2_ADDR A:0x7899920
y.create.l HWIO_BLSP1_BLSP_BAM_BAM_P_DATA_FIFO_ADDR_LSB3_ADDR A:0x789a920
y.create.l HWIO_BLSP1_BLSP_BAM_BAM_P_DATA_FIFO_ADDR_LSB4_ADDR A:0x789b920
y.create.l HWIO_BLSP1_BLSP_BAM_BAM_P_DATA_FIFO_ADDR_LSB5_ADDR A:0x789c920
y.create.l HWIO_BLSP1_BLSP_BAM_BAM_P_DATA_FIFO_ADDR_LSB6_ADDR A:0x789d920
y.create.l HWIO_BLSP1_BLSP_BAM_BAM_P_DATA_FIFO_ADDR_LSB7_ADDR A:0x789e920
y.create.l HWIO_BLSP1_BLSP_BAM_BAM_P_DATA_FIFO_ADDR_LSB8_ADDR A:0x789f920
y.create.l HWIO_BLSP1_BLSP_BAM_BAM_P_DATA_FIFO_ADDR_LSB9_ADDR A:0x78a0920
y.create.l HWIO_BLSP1_BLSP_BAM_BAM_P_DATA_FIFO_ADDR_MSB0_ADDR A:0x7897924
y.create.l HWIO_BLSP1_BLSP_BAM_BAM_P_DATA_FIFO_ADDR_MSB1_ADDR A:0x7898924
y.create.l HWIO_BLSP1_BLSP_BAM_BAM_P_DATA_FIFO_ADDR_MSB2_ADDR A:0x7899924
y.create.l HWIO_BLSP1_BLSP_BAM_BAM_P_DATA_FIFO_ADDR_MSB3_ADDR A:0x789a924
y.create.l HWIO_BLSP1_BLSP_BAM_BAM_P_DATA_FIFO_ADDR_MSB4_ADDR A:0x789b924
y.create.l HWIO_BLSP1_BLSP_BAM_BAM_P_DATA_FIFO_ADDR_MSB5_ADDR A:0x789c924
y.create.l HWIO_BLSP1_BLSP_BAM_BAM_P_DATA_FIFO_ADDR_MSB6_ADDR A:0x789d924
y.create.l HWIO_BLSP1_BLSP_BAM_BAM_P_DATA_FIFO_ADDR_MSB7_ADDR A:0x789e924
y.create.l HWIO_BLSP1_BLSP_BAM_BAM_P_DATA_FIFO_ADDR_MSB8_ADDR A:0x789f924
y.create.l HWIO_BLSP1_BLSP_BAM_BAM_P_DATA_FIFO_ADDR_MSB9_ADDR A:0x78a0924
y.create.l HWIO_BLSP1_BLSP_BAM_BAM_P_EVNT_DEST_ADDR_LSB0_ADDR A:0x7897930
y.create.l HWIO_BLSP1_BLSP_BAM_BAM_P_EVNT_DEST_ADDR_LSB1_ADDR A:0x7898930
y.create.l HWIO_BLSP1_BLSP_BAM_BAM_P_EVNT_DEST_ADDR_LSB2_ADDR A:0x7899930
y.create.l HWIO_BLSP1_BLSP_BAM_BAM_P_EVNT_DEST_ADDR_LSB3_ADDR A:0x789a930
y.create.l HWIO_BLSP1_BLSP_BAM_BAM_P_EVNT_DEST_ADDR_LSB4_ADDR A:0x789b930
y.create.l HWIO_BLSP1_BLSP_BAM_BAM_P_EVNT_DEST_ADDR_LSB5_ADDR A:0x789c930
y.create.l HWIO_BLSP1_BLSP_BAM_BAM_P_EVNT_DEST_ADDR_LSB6_ADDR A:0x789d930
y.create.l HWIO_BLSP1_BLSP_BAM_BAM_P_EVNT_DEST_ADDR_LSB7_ADDR A:0x789e930
y.create.l HWIO_BLSP1_BLSP_BAM_BAM_P_EVNT_DEST_ADDR_LSB8_ADDR A:0x789f930
y.create.l HWIO_BLSP1_BLSP_BAM_BAM_P_EVNT_DEST_ADDR_LSB9_ADDR A:0x78a0930
y.create.l HWIO_BLSP1_BLSP_BAM_BAM_P_EVNT_DEST_ADDR_MSB0_ADDR A:0x7897934
y.create.l HWIO_BLSP1_BLSP_BAM_BAM_P_EVNT_DEST_ADDR_MSB1_ADDR A:0x7898934
y.create.l HWIO_BLSP1_BLSP_BAM_BAM_P_EVNT_DEST_ADDR_MSB2_ADDR A:0x7899934
y.create.l HWIO_BLSP1_BLSP_BAM_BAM_P_EVNT_DEST_ADDR_MSB3_ADDR A:0x789a934
y.create.l HWIO_BLSP1_BLSP_BAM_BAM_P_EVNT_DEST_ADDR_MSB4_ADDR A:0x789b934
y.create.l HWIO_BLSP1_BLSP_BAM_BAM_P_EVNT_DEST_ADDR_MSB5_ADDR A:0x789c934
y.create.l HWIO_BLSP1_BLSP_BAM_BAM_P_EVNT_DEST_ADDR_MSB6_ADDR A:0x789d934
y.create.l HWIO_BLSP1_BLSP_BAM_BAM_P_EVNT_DEST_ADDR_MSB7_ADDR A:0x789e934
y.create.l HWIO_BLSP1_BLSP_BAM_BAM_P_EVNT_DEST_ADDR_MSB8_ADDR A:0x789f934
y.create.l HWIO_BLSP1_BLSP_BAM_BAM_P_EVNT_DEST_ADDR_MSB9_ADDR A:0x78a0934
y.create.l HWIO_BLSP1_BLSP_BAM_XPU_SCR_ADDR A:0x7882000
y.create.l HWIO_BLSP1_BLSP_BAM_XPU_SWDR_ADDR A:0x7882004
y.create.l HWIO_BLSP1_BLSP_BAM_XPU_SEAR0_ADDR A:0x7882040
y.create.l HWIO_BLSP1_BLSP_BAM_XPU_SESR_ADDR A:0x7882048
y.create.l HWIO_BLSP1_BLSP_BAM_XPU_SESRRESTORE_ADDR A:0x788204c
y.create.l HWIO_BLSP1_BLSP_BAM_XPU_SESYNR0_ADDR A:0x7882050
y.create.l HWIO_BLSP1_BLSP_BAM_XPU_SESYNR1_ADDR A:0x7882054
y.create.l HWIO_BLSP1_BLSP_BAM_XPU_SESYNR2_ADDR A:0x7882058
y.create.l HWIO_BLSP1_BLSP_BAM_XPU_MCR_ADDR A:0x7882100
y.create.l HWIO_BLSP1_BLSP_BAM_XPU_MEAR0_ADDR A:0x7882140
y.create.l HWIO_BLSP1_BLSP_BAM_XPU_MESR_ADDR A:0x7882148
y.create.l HWIO_BLSP1_BLSP_BAM_XPU_MESRRESTORE_ADDR A:0x788214c
y.create.l HWIO_BLSP1_BLSP_BAM_XPU_MESYNR0_ADDR A:0x7882150
y.create.l HWIO_BLSP1_BLSP_BAM_XPU_MESYNR1_ADDR A:0x7882154
y.create.l HWIO_BLSP1_BLSP_BAM_XPU_MESYNR2_ADDR A:0x7882158
y.create.l HWIO_BLSP1_BLSP_BAM_XPU_CR_ADDR A:0x7882080
y.create.l HWIO_BLSP1_BLSP_BAM_XPU_RPU_ACR0_ADDR A:0x78820a0
y.create.l HWIO_BLSP1_BLSP_BAM_XPU_EAR0_ADDR A:0x78820c0
y.create.l HWIO_BLSP1_BLSP_BAM_XPU_ESR_ADDR A:0x78820c8
y.create.l HWIO_BLSP1_BLSP_BAM_XPU_ESRRESTORE_ADDR A:0x78820cc
y.create.l HWIO_BLSP1_BLSP_BAM_XPU_ESYNR0_ADDR A:0x78820d0
y.create.l HWIO_BLSP1_BLSP_BAM_XPU_ESYNR1_ADDR A:0x78820d4
y.create.l HWIO_BLSP1_BLSP_BAM_XPU_ESYNR2_ADDR A:0x78820d8
y.create.l HWIO_BLSP1_BLSP_BAM_XPU_IDR0_ADDR A:0x7882074
y.create.l HWIO_BLSP1_BLSP_BAM_XPU_IDR1_ADDR A:0x7882078
y.create.l HWIO_BLSP1_BLSP_BAM_XPU_REV_ADDR A:0x788207c
y.create.l HWIO_BLSP1_BLSP_BAM_XPU_RG0_RACR0_ADDR A:0x7882200
y.create.l HWIO_BLSP1_BLSP_BAM_XPU_RG1_RACR0_ADDR A:0x7882280
y.create.l HWIO_BLSP1_BLSP_BAM_XPU_RG2_RACR0_ADDR A:0x7882300
y.create.l HWIO_BLSP1_BLSP_BAM_XPU_RG3_RACR0_ADDR A:0x7882380
y.create.l HWIO_BLSP1_BLSP_BAM_XPU_RG4_RACR0_ADDR A:0x7882400
y.create.l HWIO_BLSP1_BLSP_BAM_XPU_RG5_RACR0_ADDR A:0x7882480
y.create.l HWIO_BLSP1_BLSP_BAM_XPU_RG6_RACR0_ADDR A:0x7882500
y.create.l HWIO_BLSP1_BLSP_BAM_XPU_RG7_RACR0_ADDR A:0x7882580
y.create.l HWIO_BLSP1_BLSP_BAM_XPU_RG8_RACR0_ADDR A:0x7882600
y.create.l HWIO_BLSP1_BLSP_BAM_XPU_RG9_RACR0_ADDR A:0x7882680
y.create.l HWIO_BLSP1_BLSP_BAM_XPU_RG0_SCR_ADDR A:0x7882250
y.create.l HWIO_BLSP1_BLSP_BAM_XPU_RG1_SCR_ADDR A:0x78822d0
y.create.l HWIO_BLSP1_BLSP_BAM_XPU_RG2_SCR_ADDR A:0x7882350
y.create.l HWIO_BLSP1_BLSP_BAM_XPU_RG3_SCR_ADDR A:0x78823d0
y.create.l HWIO_BLSP1_BLSP_BAM_XPU_RG4_SCR_ADDR A:0x7882450
y.create.l HWIO_BLSP1_BLSP_BAM_XPU_RG5_SCR_ADDR A:0x78824d0
y.create.l HWIO_BLSP1_BLSP_BAM_XPU_RG6_SCR_ADDR A:0x7882550
y.create.l HWIO_BLSP1_BLSP_BAM_XPU_RG7_SCR_ADDR A:0x78825d0
y.create.l HWIO_BLSP1_BLSP_BAM_XPU_RG8_SCR_ADDR A:0x7882650
y.create.l HWIO_BLSP1_BLSP_BAM_XPU_RG9_SCR_ADDR A:0x78826d0
y.create.l HWIO_BLSP1_BLSP_BAM_XPU_RG0_MCR_ADDR A:0x7882254
y.create.l HWIO_BLSP1_BLSP_BAM_XPU_RG1_MCR_ADDR A:0x78822d4
y.create.l HWIO_BLSP1_BLSP_BAM_XPU_RG2_MCR_ADDR A:0x7882354
y.create.l HWIO_BLSP1_BLSP_BAM_XPU_RG3_MCR_ADDR A:0x78823d4
y.create.l HWIO_BLSP1_BLSP_BAM_XPU_RG4_MCR_ADDR A:0x7882454
y.create.l HWIO_BLSP1_BLSP_BAM_XPU_RG5_MCR_ADDR A:0x78824d4
y.create.l HWIO_BLSP1_BLSP_BAM_XPU_RG6_MCR_ADDR A:0x7882554
y.create.l HWIO_BLSP1_BLSP_BAM_XPU_RG7_MCR_ADDR A:0x78825d4
y.create.l HWIO_BLSP1_BLSP_BAM_XPU_RG8_MCR_ADDR A:0x7882654
y.create.l HWIO_BLSP1_BLSP_BAM_XPU_RG9_MCR_ADDR A:0x78826d4
y.create.l HWIO_BLSP1_BLSP_BAM_VMIDMT_SCR0_ADDR A:0x7880000
y.create.l HWIO_BLSP1_BLSP_BAM_VMIDMT_SCR1_ADDR A:0x7880004
y.create.l HWIO_BLSP1_BLSP_BAM_VMIDMT_SCR2_ADDR A:0x7880008
y.create.l HWIO_BLSP1_BLSP_BAM_VMIDMT_SACR_ADDR A:0x7880010
y.create.l HWIO_BLSP1_BLSP_BAM_VMIDMT_SIDR0_ADDR A:0x7880020
y.create.l HWIO_BLSP1_BLSP_BAM_VMIDMT_SIDR1_ADDR A:0x7880024
y.create.l HWIO_BLSP1_BLSP_BAM_VMIDMT_SIDR2_ADDR A:0x7880028
y.create.l HWIO_BLSP1_BLSP_BAM_VMIDMT_SIDR4_ADDR A:0x7880030
y.create.l HWIO_BLSP1_BLSP_BAM_VMIDMT_SIDR5_ADDR A:0x7880034
y.create.l HWIO_BLSP1_BLSP_BAM_VMIDMT_SIDR7_ADDR A:0x788003c
y.create.l HWIO_BLSP1_BLSP_BAM_VMIDMT_SGFAR0_ADDR A:0x7880040
y.create.l HWIO_BLSP1_BLSP_BAM_VMIDMT_SGFSR_ADDR A:0x7880048
y.create.l HWIO_BLSP1_BLSP_BAM_VMIDMT_SGFSRRESTORE_ADDR A:0x788004c
y.create.l HWIO_BLSP1_BLSP_BAM_VMIDMT_SGFSYNDR0_ADDR A:0x7880050
y.create.l HWIO_BLSP1_BLSP_BAM_VMIDMT_SGFSYNDR1_ADDR A:0x7880054
y.create.l HWIO_BLSP1_BLSP_BAM_VMIDMT_SGFSYNDR2_ADDR A:0x7880058
y.create.l HWIO_BLSP1_BLSP_BAM_VMIDMT_VMIDMTSCR0_ADDR A:0x7880090
y.create.l HWIO_BLSP1_BLSP_BAM_VMIDMT_CR0_ADDR A:0x7880000
y.create.l HWIO_BLSP1_BLSP_BAM_VMIDMT_CR2_ADDR A:0x7880008
y.create.l HWIO_BLSP1_BLSP_BAM_VMIDMT_ACR_ADDR A:0x7880010
y.create.l HWIO_BLSP1_BLSP_BAM_VMIDMT_IDR0_ADDR A:0x7880020
y.create.l HWIO_BLSP1_BLSP_BAM_VMIDMT_IDR1_ADDR A:0x7880024
y.create.l HWIO_BLSP1_BLSP_BAM_VMIDMT_IDR2_ADDR A:0x7880028
y.create.l HWIO_BLSP1_BLSP_BAM_VMIDMT_IDR4_ADDR A:0x7880030
y.create.l HWIO_BLSP1_BLSP_BAM_VMIDMT_IDR5_ADDR A:0x7880034
y.create.l HWIO_BLSP1_BLSP_BAM_VMIDMT_IDR7_ADDR A:0x788003c
y.create.l HWIO_BLSP1_BLSP_BAM_VMIDMT_GFAR0_ADDR A:0x7880040
y.create.l HWIO_BLSP1_BLSP_BAM_VMIDMT_GFSR_ADDR A:0x7880048
y.create.l HWIO_BLSP1_BLSP_BAM_VMIDMT_GFSRRESTORE_ADDR A:0x788004c
y.create.l HWIO_BLSP1_BLSP_BAM_VMIDMT_GFSYNDR0_ADDR A:0x7880050
y.create.l HWIO_BLSP1_BLSP_BAM_VMIDMT_GFSYNDR1_ADDR A:0x7880054
y.create.l HWIO_BLSP1_BLSP_BAM_VMIDMT_GFSYNDR2_ADDR A:0x7880058
y.create.l HWIO_BLSP1_BLSP_BAM_VMIDMT_VMIDMTCR0_ADDR A:0x7880090
y.create.l HWIO_BLSP1_BLSP_BAM_VMIDMT_VMIDMTACR_ADDR A:0x788009c
y.create.l HWIO_BLSP1_BLSP_BAM_VMIDMT_NSCR0_ADDR A:0x7880400
y.create.l HWIO_BLSP1_BLSP_BAM_VMIDMT_NSCR2_ADDR A:0x7880408
y.create.l HWIO_BLSP1_BLSP_BAM_VMIDMT_NSACR_ADDR A:0x7880410
y.create.l HWIO_BLSP1_BLSP_BAM_VMIDMT_NSGFAR0_ADDR A:0x7880440
y.create.l HWIO_BLSP1_BLSP_BAM_VMIDMT_NSGFSR_ADDR A:0x7880448
y.create.l HWIO_BLSP1_BLSP_BAM_VMIDMT_NSGFSRRESTORE_ADDR A:0x788044c
y.create.l HWIO_BLSP1_BLSP_BAM_VMIDMT_NSGFSYNDR0_ADDR A:0x7880450
y.create.l HWIO_BLSP1_BLSP_BAM_VMIDMT_NSGFSYNDR1_ADDR A:0x7880454
y.create.l HWIO_BLSP1_BLSP_BAM_VMIDMT_NSGFSYNDR2_ADDR A:0x7880458
y.create.l HWIO_BLSP1_BLSP_BAM_VMIDMT_NSVMIDMTCR0_ADDR A:0x7880490
y.create.l HWIO_BLSP1_BLSP_BAM_VMIDMT_SSDR0_ADDR A:0x7880080
y.create.l HWIO_BLSP1_BLSP_BAM_VMIDMT_MSDR0_ADDR A:0x7880480
y.create.l HWIO_BLSP1_BLSP_BAM_VMIDMT_MCR_ADDR A:0x7880494
y.create.l HWIO_BLSP1_BLSP_BAM_VMIDMT_S2VR0_ADDR A:0x7880c00
y.create.l HWIO_BLSP1_BLSP_BAM_VMIDMT_S2VR1_ADDR A:0x7880c04
y.create.l HWIO_BLSP1_BLSP_BAM_VMIDMT_S2VR2_ADDR A:0x7880c08
y.create.l HWIO_BLSP1_BLSP_BAM_VMIDMT_S2VR3_ADDR A:0x7880c0c
y.create.l HWIO_BLSP1_BLSP_BAM_VMIDMT_S2VR4_ADDR A:0x7880c10
y.create.l HWIO_BLSP1_BLSP_BAM_VMIDMT_S2VR5_ADDR A:0x7880c14
y.create.l HWIO_BLSP1_BLSP_BAM_VMIDMT_S2VR6_ADDR A:0x7880c18
y.create.l HWIO_BLSP1_BLSP_BAM_VMIDMT_S2VR7_ADDR A:0x7880c1c
y.create.l HWIO_BLSP1_BLSP_BAM_VMIDMT_S2VR8_ADDR A:0x7880c20
y.create.l HWIO_BLSP1_BLSP_BAM_VMIDMT_S2VR9_ADDR A:0x7880c24
y.create.l HWIO_BLSP1_BLSP_BAM_VMIDMT_AS2VR0_ADDR A:0x7880e00
y.create.l HWIO_BLSP1_BLSP_BAM_VMIDMT_AS2VR1_ADDR A:0x7880e04
y.create.l HWIO_BLSP1_BLSP_BAM_VMIDMT_AS2VR2_ADDR A:0x7880e08
y.create.l HWIO_BLSP1_BLSP_BAM_VMIDMT_AS2VR3_ADDR A:0x7880e0c
y.create.l HWIO_BLSP1_BLSP_BAM_VMIDMT_AS2VR4_ADDR A:0x7880e10
y.create.l HWIO_BLSP1_BLSP_BAM_VMIDMT_AS2VR5_ADDR A:0x7880e14
y.create.l HWIO_BLSP1_BLSP_BAM_VMIDMT_AS2VR6_ADDR A:0x7880e18
y.create.l HWIO_BLSP1_BLSP_BAM_VMIDMT_AS2VR7_ADDR A:0x7880e1c
y.create.l HWIO_BLSP1_BLSP_BAM_VMIDMT_AS2VR8_ADDR A:0x7880e20
y.create.l HWIO_BLSP1_BLSP_BAM_VMIDMT_AS2VR9_ADDR A:0x7880e24
y.create.l HWIO_BLSP1_BLSP_BAM_VMIDMT_SMR0_ADDR A:0x7880800
y.create.l HWIO_BLSP1_BLSP_BAM_VMIDMT_SMR1_ADDR A:0x7880804
y.create.l HWIO_BLSP1_BLSP_BAM_VMIDMT_SMR2_ADDR A:0x7880808
y.create.l HWIO_BLSP1_BLSP_BAM_VMIDMT_SMR3_ADDR A:0x788080c
y.create.l HWIO_BLSP1_BLSP_BAM_VMIDMT_SMR4_ADDR A:0x7880810
y.create.l HWIO_BLSP1_BLSP_BAM_VMIDMT_SMR5_ADDR A:0x7880814
y.create.l HWIO_BLSP1_BLSP_BAM_VMIDMT_SMR6_ADDR A:0x7880818
y.create.l HWIO_BLSP1_BLSP_BAM_VMIDMT_SMR7_ADDR A:0x788081c
y.create.l HWIO_BLSP1_BLSP_BAM_VMIDMT_SMR8_ADDR A:0x7880820
y.create.l HWIO_BLSP1_BLSP_BAM_VMIDMT_SMR9_ADDR A:0x7880824
y.create.l HWIO_BLSP1_BLSP_UART0_UART_DM_MR1_ADDR A:0x78af000
y.create.l HWIO_BLSP1_BLSP_UART0_UART_DM_MR2_ADDR A:0x78af004
y.create.l HWIO_BLSP1_BLSP_UART0_UART_DM_CSR_SR_DEPRECATED_ADDR A:0x78af008
y.create.l HWIO_BLSP1_BLSP_UART0_UART_DM_CR_MISR_DEPRECATED_ADDR A:0x78af010
y.create.l HWIO_BLSP1_BLSP_UART0_UART_DM_IMR_ISR_DEPRECATED_ADDR A:0x78af014
y.create.l HWIO_BLSP1_BLSP_UART0_UART_DM_IPR_ADDR A:0x78af018
y.create.l HWIO_BLSP1_BLSP_UART0_UART_DM_TFWR_ADDR A:0x78af01c
y.create.l HWIO_BLSP1_BLSP_UART0_UART_DM_RFWR_ADDR A:0x78af020
y.create.l HWIO_BLSP1_BLSP_UART0_UART_DM_HCR_ADDR A:0x78af024
y.create.l HWIO_BLSP1_BLSP_UART0_UART_DM_DMRX_ADDR A:0x78af034
y.create.l HWIO_BLSP1_BLSP_UART0_UART_DM_IRDA_RX_TOTAL_SNAP_DEPRECATED_ADDR A:0x78af038
y.create.l HWIO_BLSP1_BLSP_UART0_UART_DM_DMEN_ADDR A:0x78af03c
y.create.l HWIO_BLSP1_BLSP_UART0_UART_DM_NO_CHARS_FOR_TX_ADDR A:0x78af040
y.create.l HWIO_BLSP1_BLSP_UART0_UART_DM_BADR_ADDR A:0x78af044
y.create.l HWIO_BLSP1_BLSP_UART0_UART_DM_TESTSL_ADDR A:0x78af048
y.create.l HWIO_BLSP1_BLSP_UART0_UART_DM_TXFS_ADDR A:0x78af04c
y.create.l HWIO_BLSP1_BLSP_UART0_UART_DM_RXFS_ADDR A:0x78af050
y.create.l HWIO_BLSP1_BLSP_UART0_UART_DM_MISR_MODE_ADDR A:0x78af060
y.create.l HWIO_BLSP1_BLSP_UART0_UART_DM_MISR_RESET_ADDR A:0x78af064
y.create.l HWIO_BLSP1_BLSP_UART0_UART_DM_MISR_EXPORT_ADDR A:0x78af068
y.create.l HWIO_BLSP1_BLSP_UART0_UART_DM_MISR_VAL_ADDR A:0x78af06c
y.create.l HWIO_BLSP1_BLSP_UART0_UART_DM_TF_RF_DEPRECATED_ADDR A:0x78af070
y.create.l HWIO_BLSP1_BLSP_UART0_UART_DM_TF_RF_2_DEPRECATED_ADDR A:0x78af074
y.create.l HWIO_BLSP1_BLSP_UART0_UART_DM_TF_RF_3_DEPRECATED_ADDR A:0x78af078
y.create.l HWIO_BLSP1_BLSP_UART0_UART_DM_TF_RF_4_DEPRECATED_ADDR A:0x78af07c
y.create.l HWIO_BLSP1_BLSP_UART0_UART_DM_SIM_CFG_ADDR A:0x78af080
y.create.l HWIO_BLSP1_BLSP_UART0_UART_DM_TEST_WR_ADDR_ADDR A:0x78af084
y.create.l HWIO_BLSP1_BLSP_UART0_UART_DM_TEST_WR_DATA_ADDR A:0x78af088
y.create.l HWIO_BLSP1_BLSP_UART0_UART_DM_TEST_RD_ADDR_ADDR A:0x78af08c
y.create.l HWIO_BLSP1_BLSP_UART0_UART_DM_TEST_RD_DATA_ADDR A:0x78af090
y.create.l HWIO_BLSP1_BLSP_UART0_UART_DM_CSR_ADDR A:0x78af0a0
y.create.l HWIO_BLSP1_BLSP_UART0_UART_DM_SR_ADDR A:0x78af0a4
y.create.l HWIO_BLSP1_BLSP_UART0_UART_DM_CR_ADDR A:0x78af0a8
y.create.l HWIO_BLSP1_BLSP_UART0_UART_DM_MISR_ADDR A:0x78af0ac
y.create.l HWIO_BLSP1_BLSP_UART0_UART_DM_IMR_ADDR A:0x78af0b0
y.create.l HWIO_BLSP1_BLSP_UART0_UART_DM_ISR_ADDR A:0x78af0b4
y.create.l HWIO_BLSP1_BLSP_UART0_UART_DM_IRDA_ADDR A:0x78af0b8
y.create.l HWIO_BLSP1_BLSP_UART0_UART_DM_RX_TOTAL_SNAP_ADDR A:0x78af0bc
y.create.l HWIO_BLSP1_BLSP_UART0_UART_DM_WWT_TIMEOUT_ADDR A:0x78af0c0
y.create.l HWIO_BLSP1_BLSP_UART0_UART_DM_CLK_CTRL_ADDR A:0x78af0c4
y.create.l HWIO_BLSP1_BLSP_UART0_UART_DM_BCR_ADDR A:0x78af0c8
y.create.l HWIO_BLSP1_BLSP_UART0_UART_DM_RX_TRANS_CTRL_ADDR A:0x78af0cc
y.create.l HWIO_BLSP1_BLSP_UART0_UART_DM_DMRX_DBG_ADDR A:0x78af0d0
y.create.l HWIO_BLSP1_BLSP_UART0_UART_DM_FSM_STATUS_ADDR A:0x78af0d4
y.create.l HWIO_BLSP1_BLSP_UART0_UART_DM_HW_VERSION_ADDR A:0x78af0d8
y.create.l HWIO_BLSP1_BLSP_UART0_UART_DM_GENERICS_ADDR A:0x78af0dc
y.create.l HWIO_BLSP1_BLSP_UART0_UART_DM_TF_ADDR A:0x78af100
y.create.l HWIO_BLSP1_BLSP_UART0_UART_DM_TF_2_ADDR A:0x78af104
y.create.l HWIO_BLSP1_BLSP_UART0_UART_DM_TF_3_ADDR A:0x78af108
y.create.l HWIO_BLSP1_BLSP_UART0_UART_DM_TF_4_ADDR A:0x78af10c
y.create.l HWIO_BLSP1_BLSP_UART0_UART_DM_TF_5_ADDR A:0x78af110
y.create.l HWIO_BLSP1_BLSP_UART0_UART_DM_TF_6_ADDR A:0x78af114
y.create.l HWIO_BLSP1_BLSP_UART0_UART_DM_TF_7_ADDR A:0x78af118
y.create.l HWIO_BLSP1_BLSP_UART0_UART_DM_TF_8_ADDR A:0x78af11c
y.create.l HWIO_BLSP1_BLSP_UART0_UART_DM_TF_9_ADDR A:0x78af120
y.create.l HWIO_BLSP1_BLSP_UART0_UART_DM_TF_10_ADDR A:0x78af124
y.create.l HWIO_BLSP1_BLSP_UART0_UART_DM_TF_11_ADDR A:0x78af128
y.create.l HWIO_BLSP1_BLSP_UART0_UART_DM_TF_12_ADDR A:0x78af12c
y.create.l HWIO_BLSP1_BLSP_UART0_UART_DM_TF_13_ADDR A:0x78af130
y.create.l HWIO_BLSP1_BLSP_UART0_UART_DM_TF_14_ADDR A:0x78af134
y.create.l HWIO_BLSP1_BLSP_UART0_UART_DM_TF_15_ADDR A:0x78af138
y.create.l HWIO_BLSP1_BLSP_UART0_UART_DM_TF_16_ADDR A:0x78af13c
y.create.l HWIO_BLSP1_BLSP_UART0_UART_DM_RF_ADDR A:0x78af140
y.create.l HWIO_BLSP1_BLSP_UART0_UART_DM_RF_2_ADDR A:0x78af144
y.create.l HWIO_BLSP1_BLSP_UART0_UART_DM_RF_3_ADDR A:0x78af148
y.create.l HWIO_BLSP1_BLSP_UART0_UART_DM_RF_4_ADDR A:0x78af14c
y.create.l HWIO_BLSP1_BLSP_UART0_UART_DM_RF_5_ADDR A:0x78af150
y.create.l HWIO_BLSP1_BLSP_UART0_UART_DM_RF_6_ADDR A:0x78af154
y.create.l HWIO_BLSP1_BLSP_UART0_UART_DM_RF_7_ADDR A:0x78af158
y.create.l HWIO_BLSP1_BLSP_UART0_UART_DM_RF_8_ADDR A:0x78af15c
y.create.l HWIO_BLSP1_BLSP_UART0_UART_DM_RF_9_ADDR A:0x78af160
y.create.l HWIO_BLSP1_BLSP_UART0_UART_DM_RF_10_ADDR A:0x78af164
y.create.l HWIO_BLSP1_BLSP_UART0_UART_DM_RF_11_ADDR A:0x78af168
y.create.l HWIO_BLSP1_BLSP_UART0_UART_DM_RF_12_ADDR A:0x78af16c
y.create.l HWIO_BLSP1_BLSP_UART0_UART_DM_RF_13_ADDR A:0x78af170
y.create.l HWIO_BLSP1_BLSP_UART0_UART_DM_RF_14_ADDR A:0x78af174
y.create.l HWIO_BLSP1_BLSP_UART0_UART_DM_RF_15_ADDR A:0x78af178
y.create.l HWIO_BLSP1_BLSP_UART0_UART_DM_RF_16_ADDR A:0x78af17c
y.create.l HWIO_BLSP1_BLSP_UART0_UART_DM_UIM_CFG_ADDR A:0x78af180
y.create.l HWIO_BLSP1_BLSP_UART0_UART_DM_UIM_CMD_ADDR A:0x78af184
y.create.l HWIO_BLSP1_BLSP_UART0_UART_DM_UIM_IO_STATUS_ADDR A:0x78af188
y.create.l HWIO_BLSP1_BLSP_UART0_UART_DM_UIM_IRQ_ISR_ADDR A:0x78af18c
y.create.l HWIO_BLSP1_BLSP_UART0_UART_DM_UIM_IRQ_MISR_ADDR A:0x78af190
y.create.l HWIO_BLSP1_BLSP_UART0_UART_DM_UIM_IRQ_CLR_ADDR A:0x78af194
y.create.l HWIO_BLSP1_BLSP_UART0_UART_DM_UIM_IRQ_IMR_ADDR A:0x78af198
y.create.l HWIO_BLSP1_BLSP_UART0_UART_DM_UIM_IRQ_IMR_SET_ADDR A:0x78af19c
y.create.l HWIO_BLSP1_BLSP_UART0_UART_DM_UIM_IRQ_IMR_CLR_ADDR A:0x78af1a0
y.create.l HWIO_BLSP1_BLSP_UART1_UART_DM_MR1_ADDR A:0x78b0000
y.create.l HWIO_BLSP1_BLSP_UART1_UART_DM_MR2_ADDR A:0x78b0004
y.create.l HWIO_BLSP1_BLSP_UART1_UART_DM_CSR_SR_DEPRECATED_ADDR A:0x78b0008
y.create.l HWIO_BLSP1_BLSP_UART1_UART_DM_CR_MISR_DEPRECATED_ADDR A:0x78b0010
y.create.l HWIO_BLSP1_BLSP_UART1_UART_DM_IMR_ISR_DEPRECATED_ADDR A:0x78b0014
y.create.l HWIO_BLSP1_BLSP_UART1_UART_DM_IPR_ADDR A:0x78b0018
y.create.l HWIO_BLSP1_BLSP_UART1_UART_DM_TFWR_ADDR A:0x78b001c
y.create.l HWIO_BLSP1_BLSP_UART1_UART_DM_RFWR_ADDR A:0x78b0020
y.create.l HWIO_BLSP1_BLSP_UART1_UART_DM_HCR_ADDR A:0x78b0024
y.create.l HWIO_BLSP1_BLSP_UART1_UART_DM_DMRX_ADDR A:0x78b0034
y.create.l HWIO_BLSP1_BLSP_UART1_UART_DM_IRDA_RX_TOTAL_SNAP_DEPRECATED_ADDR A:0x78b0038
y.create.l HWIO_BLSP1_BLSP_UART1_UART_DM_DMEN_ADDR A:0x78b003c
y.create.l HWIO_BLSP1_BLSP_UART1_UART_DM_NO_CHARS_FOR_TX_ADDR A:0x78b0040
y.create.l HWIO_BLSP1_BLSP_UART1_UART_DM_BADR_ADDR A:0x78b0044
y.create.l HWIO_BLSP1_BLSP_UART1_UART_DM_TESTSL_ADDR A:0x78b0048
y.create.l HWIO_BLSP1_BLSP_UART1_UART_DM_TXFS_ADDR A:0x78b004c
y.create.l HWIO_BLSP1_BLSP_UART1_UART_DM_RXFS_ADDR A:0x78b0050
y.create.l HWIO_BLSP1_BLSP_UART1_UART_DM_MISR_MODE_ADDR A:0x78b0060
y.create.l HWIO_BLSP1_BLSP_UART1_UART_DM_MISR_RESET_ADDR A:0x78b0064
y.create.l HWIO_BLSP1_BLSP_UART1_UART_DM_MISR_EXPORT_ADDR A:0x78b0068
y.create.l HWIO_BLSP1_BLSP_UART1_UART_DM_MISR_VAL_ADDR A:0x78b006c
y.create.l HWIO_BLSP1_BLSP_UART1_UART_DM_TF_RF_DEPRECATED_ADDR A:0x78b0070
y.create.l HWIO_BLSP1_BLSP_UART1_UART_DM_TF_RF_2_DEPRECATED_ADDR A:0x78b0074
y.create.l HWIO_BLSP1_BLSP_UART1_UART_DM_TF_RF_3_DEPRECATED_ADDR A:0x78b0078
y.create.l HWIO_BLSP1_BLSP_UART1_UART_DM_TF_RF_4_DEPRECATED_ADDR A:0x78b007c
y.create.l HWIO_BLSP1_BLSP_UART1_UART_DM_SIM_CFG_ADDR A:0x78b0080
y.create.l HWIO_BLSP1_BLSP_UART1_UART_DM_TEST_WR_ADDR_ADDR A:0x78b0084
y.create.l HWIO_BLSP1_BLSP_UART1_UART_DM_TEST_WR_DATA_ADDR A:0x78b0088
y.create.l HWIO_BLSP1_BLSP_UART1_UART_DM_TEST_RD_ADDR_ADDR A:0x78b008c
y.create.l HWIO_BLSP1_BLSP_UART1_UART_DM_TEST_RD_DATA_ADDR A:0x78b0090
y.create.l HWIO_BLSP1_BLSP_UART1_UART_DM_CSR_ADDR A:0x78b00a0
y.create.l HWIO_BLSP1_BLSP_UART1_UART_DM_SR_ADDR A:0x78b00a4
y.create.l HWIO_BLSP1_BLSP_UART1_UART_DM_CR_ADDR A:0x78b00a8
y.create.l HWIO_BLSP1_BLSP_UART1_UART_DM_MISR_ADDR A:0x78b00ac
y.create.l HWIO_BLSP1_BLSP_UART1_UART_DM_IMR_ADDR A:0x78b00b0
y.create.l HWIO_BLSP1_BLSP_UART1_UART_DM_ISR_ADDR A:0x78b00b4
y.create.l HWIO_BLSP1_BLSP_UART1_UART_DM_IRDA_ADDR A:0x78b00b8
y.create.l HWIO_BLSP1_BLSP_UART1_UART_DM_RX_TOTAL_SNAP_ADDR A:0x78b00bc
y.create.l HWIO_BLSP1_BLSP_UART1_UART_DM_WWT_TIMEOUT_ADDR A:0x78b00c0
y.create.l HWIO_BLSP1_BLSP_UART1_UART_DM_CLK_CTRL_ADDR A:0x78b00c4
y.create.l HWIO_BLSP1_BLSP_UART1_UART_DM_BCR_ADDR A:0x78b00c8
y.create.l HWIO_BLSP1_BLSP_UART1_UART_DM_RX_TRANS_CTRL_ADDR A:0x78b00cc
y.create.l HWIO_BLSP1_BLSP_UART1_UART_DM_DMRX_DBG_ADDR A:0x78b00d0
y.create.l HWIO_BLSP1_BLSP_UART1_UART_DM_FSM_STATUS_ADDR A:0x78b00d4
y.create.l HWIO_BLSP1_BLSP_UART1_UART_DM_HW_VERSION_ADDR A:0x78b00d8
y.create.l HWIO_BLSP1_BLSP_UART1_UART_DM_GENERICS_ADDR A:0x78b00dc
y.create.l HWIO_BLSP1_BLSP_UART1_UART_DM_TF_ADDR A:0x78b0100
y.create.l HWIO_BLSP1_BLSP_UART1_UART_DM_TF_2_ADDR A:0x78b0104
y.create.l HWIO_BLSP1_BLSP_UART1_UART_DM_TF_3_ADDR A:0x78b0108
y.create.l HWIO_BLSP1_BLSP_UART1_UART_DM_TF_4_ADDR A:0x78b010c
y.create.l HWIO_BLSP1_BLSP_UART1_UART_DM_TF_5_ADDR A:0x78b0110
y.create.l HWIO_BLSP1_BLSP_UART1_UART_DM_TF_6_ADDR A:0x78b0114
y.create.l HWIO_BLSP1_BLSP_UART1_UART_DM_TF_7_ADDR A:0x78b0118
y.create.l HWIO_BLSP1_BLSP_UART1_UART_DM_TF_8_ADDR A:0x78b011c
y.create.l HWIO_BLSP1_BLSP_UART1_UART_DM_TF_9_ADDR A:0x78b0120
y.create.l HWIO_BLSP1_BLSP_UART1_UART_DM_TF_10_ADDR A:0x78b0124
y.create.l HWIO_BLSP1_BLSP_UART1_UART_DM_TF_11_ADDR A:0x78b0128
y.create.l HWIO_BLSP1_BLSP_UART1_UART_DM_TF_12_ADDR A:0x78b012c
y.create.l HWIO_BLSP1_BLSP_UART1_UART_DM_TF_13_ADDR A:0x78b0130
y.create.l HWIO_BLSP1_BLSP_UART1_UART_DM_TF_14_ADDR A:0x78b0134
y.create.l HWIO_BLSP1_BLSP_UART1_UART_DM_TF_15_ADDR A:0x78b0138
y.create.l HWIO_BLSP1_BLSP_UART1_UART_DM_TF_16_ADDR A:0x78b013c
y.create.l HWIO_BLSP1_BLSP_UART1_UART_DM_RF_ADDR A:0x78b0140
y.create.l HWIO_BLSP1_BLSP_UART1_UART_DM_RF_2_ADDR A:0x78b0144
y.create.l HWIO_BLSP1_BLSP_UART1_UART_DM_RF_3_ADDR A:0x78b0148
y.create.l HWIO_BLSP1_BLSP_UART1_UART_DM_RF_4_ADDR A:0x78b014c
y.create.l HWIO_BLSP1_BLSP_UART1_UART_DM_RF_5_ADDR A:0x78b0150
y.create.l HWIO_BLSP1_BLSP_UART1_UART_DM_RF_6_ADDR A:0x78b0154
y.create.l HWIO_BLSP1_BLSP_UART1_UART_DM_RF_7_ADDR A:0x78b0158
y.create.l HWIO_BLSP1_BLSP_UART1_UART_DM_RF_8_ADDR A:0x78b015c
y.create.l HWIO_BLSP1_BLSP_UART1_UART_DM_RF_9_ADDR A:0x78b0160
y.create.l HWIO_BLSP1_BLSP_UART1_UART_DM_RF_10_ADDR A:0x78b0164
y.create.l HWIO_BLSP1_BLSP_UART1_UART_DM_RF_11_ADDR A:0x78b0168
y.create.l HWIO_BLSP1_BLSP_UART1_UART_DM_RF_12_ADDR A:0x78b016c
y.create.l HWIO_BLSP1_BLSP_UART1_UART_DM_RF_13_ADDR A:0x78b0170
y.create.l HWIO_BLSP1_BLSP_UART1_UART_DM_RF_14_ADDR A:0x78b0174
y.create.l HWIO_BLSP1_BLSP_UART1_UART_DM_RF_15_ADDR A:0x78b0178
y.create.l HWIO_BLSP1_BLSP_UART1_UART_DM_RF_16_ADDR A:0x78b017c
y.create.l HWIO_BLSP1_BLSP_UART1_UART_DM_UIM_CFG_ADDR A:0x78b0180
y.create.l HWIO_BLSP1_BLSP_UART1_UART_DM_UIM_CMD_ADDR A:0x78b0184
y.create.l HWIO_BLSP1_BLSP_UART1_UART_DM_UIM_IO_STATUS_ADDR A:0x78b0188
y.create.l HWIO_BLSP1_BLSP_UART1_UART_DM_UIM_IRQ_ISR_ADDR A:0x78b018c
y.create.l HWIO_BLSP1_BLSP_UART1_UART_DM_UIM_IRQ_MISR_ADDR A:0x78b0190
y.create.l HWIO_BLSP1_BLSP_UART1_UART_DM_UIM_IRQ_CLR_ADDR A:0x78b0194
y.create.l HWIO_BLSP1_BLSP_UART1_UART_DM_UIM_IRQ_IMR_ADDR A:0x78b0198
y.create.l HWIO_BLSP1_BLSP_UART1_UART_DM_UIM_IRQ_IMR_SET_ADDR A:0x78b019c
y.create.l HWIO_BLSP1_BLSP_UART1_UART_DM_UIM_IRQ_IMR_CLR_ADDR A:0x78b01a0
y.create.l HWIO_BLSP1_BLSP_QUP0_QUP_CONFIG_ADDR A:0x78b5000
y.create.l HWIO_BLSP1_BLSP_QUP0_QUP_STATE_ADDR A:0x78b5004
y.create.l HWIO_BLSP1_BLSP_QUP0_QUP_IO_MODES_ADDR A:0x78b5008
y.create.l HWIO_BLSP1_BLSP_QUP0_QUP_SW_RESET_ADDR A:0x78b500c
y.create.l HWIO_BLSP1_BLSP_QUP0_QUP_TRANSFER_CANCEL_ADDR A:0x78b5014
y.create.l HWIO_BLSP1_BLSP_QUP0_QUP_OPERATIONAL_ADDR A:0x78b5018
y.create.l HWIO_BLSP1_BLSP_QUP0_QUP_ERROR_FLAGS_ADDR A:0x78b501c
y.create.l HWIO_BLSP1_BLSP_QUP0_QUP_ERROR_FLAGS_EN_ADDR A:0x78b5020
y.create.l HWIO_BLSP1_BLSP_QUP0_QUP_TEST_CTRL_ADDR A:0x78b5024
y.create.l HWIO_BLSP1_BLSP_QUP0_QUP_OPERATIONAL_MASK_ADDR A:0x78b5028
y.create.l HWIO_BLSP1_BLSP_QUP0_QUP_HW_VERSION_ADDR A:0x78b5030
y.create.l HWIO_BLSP1_BLSP_QUP0_QUP_MX_OUTPUT_COUNT_ADDR A:0x78b5100
y.create.l HWIO_BLSP1_BLSP_QUP0_QUP_MX_OUTPUT_CNT_CURRENT_ADDR A:0x78b5104
y.create.l HWIO_BLSP1_BLSP_QUP0_QUP_OUTPUT_DEBUG_ADDR A:0x78b5108
y.create.l HWIO_BLSP1_BLSP_QUP0_QUP_OUTPUT_FIFO_WORD_CNT_ADDR A:0x78b510c
y.create.l HWIO_BLSP1_BLSP_QUP0_QUP_OUTPUT_FIFO0_ADDR A:0x78b5110
y.create.l HWIO_BLSP1_BLSP_QUP0_QUP_OUTPUT_FIFO1_ADDR A:0x78b5114
y.create.l HWIO_BLSP1_BLSP_QUP0_QUP_OUTPUT_FIFO2_ADDR A:0x78b5118
y.create.l HWIO_BLSP1_BLSP_QUP0_QUP_OUTPUT_FIFO3_ADDR A:0x78b511c
y.create.l HWIO_BLSP1_BLSP_QUP0_QUP_OUTPUT_FIFO4_ADDR A:0x78b5120
y.create.l HWIO_BLSP1_BLSP_QUP0_QUP_OUTPUT_FIFO5_ADDR A:0x78b5124
y.create.l HWIO_BLSP1_BLSP_QUP0_QUP_OUTPUT_FIFO6_ADDR A:0x78b5128
y.create.l HWIO_BLSP1_BLSP_QUP0_QUP_OUTPUT_FIFO7_ADDR A:0x78b512c
y.create.l HWIO_BLSP1_BLSP_QUP0_QUP_OUTPUT_FIFO8_ADDR A:0x78b5130
y.create.l HWIO_BLSP1_BLSP_QUP0_QUP_OUTPUT_FIFO9_ADDR A:0x78b5134
y.create.l HWIO_BLSP1_BLSP_QUP0_QUP_MX_WRITE_COUNT_ADDR A:0x78b5150
y.create.l HWIO_BLSP1_BLSP_QUP0_QUP_MX_WRITE_CNT_CURRENT_ADDR A:0x78b5154
y.create.l HWIO_BLSP1_BLSP_QUP0_QUP_MX_INPUT_COUNT_ADDR A:0x78b5200
y.create.l HWIO_BLSP1_BLSP_QUP0_QUP_MX_INPUT_CNT_CURRENT_ADDR A:0x78b5204
y.create.l HWIO_BLSP1_BLSP_QUP0_QUP_MX_READ_COUNT_ADDR A:0x78b5208
y.create.l HWIO_BLSP1_BLSP_QUP0_QUP_MX_READ_CNT_CURRENT_ADDR A:0x78b520c
y.create.l HWIO_BLSP1_BLSP_QUP0_QUP_INPUT_DEBUG_ADDR A:0x78b5210
y.create.l HWIO_BLSP1_BLSP_QUP0_QUP_INPUT_FIFO_WORD_CNT_ADDR A:0x78b5214
y.create.l HWIO_BLSP1_BLSP_QUP0_QUP_INPUT_FIFO0_ADDR A:0x78b5218
y.create.l HWIO_BLSP1_BLSP_QUP0_QUP_INPUT_FIFO1_ADDR A:0x78b521c
y.create.l HWIO_BLSP1_BLSP_QUP0_QUP_INPUT_FIFO2_ADDR A:0x78b5220
y.create.l HWIO_BLSP1_BLSP_QUP0_QUP_INPUT_FIFO3_ADDR A:0x78b5224
y.create.l HWIO_BLSP1_BLSP_QUP0_QUP_INPUT_FIFO4_ADDR A:0x78b5228
y.create.l HWIO_BLSP1_BLSP_QUP0_QUP_INPUT_FIFO5_ADDR A:0x78b522c
y.create.l HWIO_BLSP1_BLSP_QUP0_QUP_INPUT_FIFO6_ADDR A:0x78b5230
y.create.l HWIO_BLSP1_BLSP_QUP0_QUP_INPUT_FIFO7_ADDR A:0x78b5234
y.create.l HWIO_BLSP1_BLSP_QUP0_QUP_INPUT_FIFO8_ADDR A:0x78b5238
y.create.l HWIO_BLSP1_BLSP_QUP0_QUP_INPUT_FIFO9_ADDR A:0x78b523c
y.create.l HWIO_BLSP1_BLSP_QUP0_SPI_CONFIG_ADDR A:0x78b5300
y.create.l HWIO_BLSP1_BLSP_QUP0_SPI_IO_CONTROL_ADDR A:0x78b5304
y.create.l HWIO_BLSP1_BLSP_QUP0_SPI_ERROR_FLAGS_ADDR A:0x78b5308
y.create.l HWIO_BLSP1_BLSP_QUP0_SPI_ERROR_FLAGS_EN_ADDR A:0x78b530c
y.create.l HWIO_BLSP1_BLSP_QUP0_SPI_DEASSERT_WAIT_ADDR A:0x78b5310
y.create.l HWIO_BLSP1_BLSP_QUP0_SPI_MASTER_LOCAL_ID_ADDR A:0x78b5314
y.create.l HWIO_BLSP1_BLSP_QUP0_SPI_MASTER_COMMAND_ADDR A:0x78b5318
y.create.l HWIO_BLSP1_BLSP_QUP0_SPI_MASTER_STATUS_ADDR A:0x78b531c
y.create.l HWIO_BLSP1_BLSP_QUP0_SPI_CHAR_CFG_ADDR A:0x78b5320
y.create.l HWIO_BLSP1_BLSP_QUP0_SPI_CHAR_DATA_SPI_CS_ADDR A:0x78b5324
y.create.l HWIO_BLSP1_BLSP_QUP0_SPI_CHAR_DATA_SPI_MOSI_ADDR A:0x78b5328
y.create.l HWIO_BLSP1_BLSP_QUP0_SPI_CHAR_DATA_SPI_MISO_ADDR A:0x78b532c
y.create.l HWIO_BLSP1_BLSP_QUP0_I2C_MASTER_CLK_CTL_ADDR A:0x78b5400
y.create.l HWIO_BLSP1_BLSP_QUP0_I2C_MASTER_STATUS_ADDR A:0x78b5404
y.create.l HWIO_BLSP1_BLSP_QUP0_I2C_MASTER_CONFIG_ADDR A:0x78b5408
y.create.l HWIO_BLSP1_BLSP_QUP0_I2C_MASTER_BUS_CLEAR_ADDR A:0x78b540c
y.create.l HWIO_BLSP1_BLSP_QUP0_I2C_MASTER_LOCAL_ID_ADDR A:0x78b5410
y.create.l HWIO_BLSP1_BLSP_QUP0_I2C_MASTER_COMMAND_ADDR A:0x78b5414
y.create.l HWIO_BLSP1_BLSP_QUP1_QUP_CONFIG_ADDR A:0x78b6000
y.create.l HWIO_BLSP1_BLSP_QUP1_QUP_STATE_ADDR A:0x78b6004
y.create.l HWIO_BLSP1_BLSP_QUP1_QUP_IO_MODES_ADDR A:0x78b6008
y.create.l HWIO_BLSP1_BLSP_QUP1_QUP_SW_RESET_ADDR A:0x78b600c
y.create.l HWIO_BLSP1_BLSP_QUP1_QUP_TRANSFER_CANCEL_ADDR A:0x78b6014
y.create.l HWIO_BLSP1_BLSP_QUP1_QUP_OPERATIONAL_ADDR A:0x78b6018
y.create.l HWIO_BLSP1_BLSP_QUP1_QUP_ERROR_FLAGS_ADDR A:0x78b601c
y.create.l HWIO_BLSP1_BLSP_QUP1_QUP_ERROR_FLAGS_EN_ADDR A:0x78b6020
y.create.l HWIO_BLSP1_BLSP_QUP1_QUP_TEST_CTRL_ADDR A:0x78b6024
y.create.l HWIO_BLSP1_BLSP_QUP1_QUP_OPERATIONAL_MASK_ADDR A:0x78b6028
y.create.l HWIO_BLSP1_BLSP_QUP1_QUP_HW_VERSION_ADDR A:0x78b6030
y.create.l HWIO_BLSP1_BLSP_QUP1_QUP_MX_OUTPUT_COUNT_ADDR A:0x78b6100
y.create.l HWIO_BLSP1_BLSP_QUP1_QUP_MX_OUTPUT_CNT_CURRENT_ADDR A:0x78b6104
y.create.l HWIO_BLSP1_BLSP_QUP1_QUP_OUTPUT_DEBUG_ADDR A:0x78b6108
y.create.l HWIO_BLSP1_BLSP_QUP1_QUP_OUTPUT_FIFO_WORD_CNT_ADDR A:0x78b610c
y.create.l HWIO_BLSP1_BLSP_QUP1_QUP_OUTPUT_FIFO0_ADDR A:0x78b6110
y.create.l HWIO_BLSP1_BLSP_QUP1_QUP_OUTPUT_FIFO1_ADDR A:0x78b6114
y.create.l HWIO_BLSP1_BLSP_QUP1_QUP_OUTPUT_FIFO2_ADDR A:0x78b6118
y.create.l HWIO_BLSP1_BLSP_QUP1_QUP_OUTPUT_FIFO3_ADDR A:0x78b611c
y.create.l HWIO_BLSP1_BLSP_QUP1_QUP_OUTPUT_FIFO4_ADDR A:0x78b6120
y.create.l HWIO_BLSP1_BLSP_QUP1_QUP_OUTPUT_FIFO5_ADDR A:0x78b6124
y.create.l HWIO_BLSP1_BLSP_QUP1_QUP_OUTPUT_FIFO6_ADDR A:0x78b6128
y.create.l HWIO_BLSP1_BLSP_QUP1_QUP_OUTPUT_FIFO7_ADDR A:0x78b612c
y.create.l HWIO_BLSP1_BLSP_QUP1_QUP_OUTPUT_FIFO8_ADDR A:0x78b6130
y.create.l HWIO_BLSP1_BLSP_QUP1_QUP_OUTPUT_FIFO9_ADDR A:0x78b6134
y.create.l HWIO_BLSP1_BLSP_QUP1_QUP_MX_WRITE_COUNT_ADDR A:0x78b6150
y.create.l HWIO_BLSP1_BLSP_QUP1_QUP_MX_WRITE_CNT_CURRENT_ADDR A:0x78b6154
y.create.l HWIO_BLSP1_BLSP_QUP1_QUP_MX_INPUT_COUNT_ADDR A:0x78b6200
y.create.l HWIO_BLSP1_BLSP_QUP1_QUP_MX_INPUT_CNT_CURRENT_ADDR A:0x78b6204
y.create.l HWIO_BLSP1_BLSP_QUP1_QUP_MX_READ_COUNT_ADDR A:0x78b6208
y.create.l HWIO_BLSP1_BLSP_QUP1_QUP_MX_READ_CNT_CURRENT_ADDR A:0x78b620c
y.create.l HWIO_BLSP1_BLSP_QUP1_QUP_INPUT_DEBUG_ADDR A:0x78b6210
y.create.l HWIO_BLSP1_BLSP_QUP1_QUP_INPUT_FIFO_WORD_CNT_ADDR A:0x78b6214
y.create.l HWIO_BLSP1_BLSP_QUP1_QUP_INPUT_FIFO0_ADDR A:0x78b6218
y.create.l HWIO_BLSP1_BLSP_QUP1_QUP_INPUT_FIFO1_ADDR A:0x78b621c
y.create.l HWIO_BLSP1_BLSP_QUP1_QUP_INPUT_FIFO2_ADDR A:0x78b6220
y.create.l HWIO_BLSP1_BLSP_QUP1_QUP_INPUT_FIFO3_ADDR A:0x78b6224
y.create.l HWIO_BLSP1_BLSP_QUP1_QUP_INPUT_FIFO4_ADDR A:0x78b6228
y.create.l HWIO_BLSP1_BLSP_QUP1_QUP_INPUT_FIFO5_ADDR A:0x78b622c
y.create.l HWIO_BLSP1_BLSP_QUP1_QUP_INPUT_FIFO6_ADDR A:0x78b6230
y.create.l HWIO_BLSP1_BLSP_QUP1_QUP_INPUT_FIFO7_ADDR A:0x78b6234
y.create.l HWIO_BLSP1_BLSP_QUP1_QUP_INPUT_FIFO8_ADDR A:0x78b6238
y.create.l HWIO_BLSP1_BLSP_QUP1_QUP_INPUT_FIFO9_ADDR A:0x78b623c
y.create.l HWIO_BLSP1_BLSP_QUP1_SPI_CONFIG_ADDR A:0x78b6300
y.create.l HWIO_BLSP1_BLSP_QUP1_SPI_IO_CONTROL_ADDR A:0x78b6304
y.create.l HWIO_BLSP1_BLSP_QUP1_SPI_ERROR_FLAGS_ADDR A:0x78b6308
y.create.l HWIO_BLSP1_BLSP_QUP1_SPI_ERROR_FLAGS_EN_ADDR A:0x78b630c
y.create.l HWIO_BLSP1_BLSP_QUP1_SPI_DEASSERT_WAIT_ADDR A:0x78b6310
y.create.l HWIO_BLSP1_BLSP_QUP1_SPI_MASTER_LOCAL_ID_ADDR A:0x78b6314
y.create.l HWIO_BLSP1_BLSP_QUP1_SPI_MASTER_COMMAND_ADDR A:0x78b6318
y.create.l HWIO_BLSP1_BLSP_QUP1_SPI_MASTER_STATUS_ADDR A:0x78b631c
y.create.l HWIO_BLSP1_BLSP_QUP1_SPI_CHAR_CFG_ADDR A:0x78b6320
y.create.l HWIO_BLSP1_BLSP_QUP1_SPI_CHAR_DATA_SPI_CS_ADDR A:0x78b6324
y.create.l HWIO_BLSP1_BLSP_QUP1_SPI_CHAR_DATA_SPI_MOSI_ADDR A:0x78b6328
y.create.l HWIO_BLSP1_BLSP_QUP1_SPI_CHAR_DATA_SPI_MISO_ADDR A:0x78b632c
y.create.l HWIO_BLSP1_BLSP_QUP1_I2C_MASTER_CLK_CTL_ADDR A:0x78b6400
y.create.l HWIO_BLSP1_BLSP_QUP1_I2C_MASTER_STATUS_ADDR A:0x78b6404
y.create.l HWIO_BLSP1_BLSP_QUP1_I2C_MASTER_CONFIG_ADDR A:0x78b6408
y.create.l HWIO_BLSP1_BLSP_QUP1_I2C_MASTER_BUS_CLEAR_ADDR A:0x78b640c
y.create.l HWIO_BLSP1_BLSP_QUP1_I2C_MASTER_LOCAL_ID_ADDR A:0x78b6410
y.create.l HWIO_BLSP1_BLSP_QUP1_I2C_MASTER_COMMAND_ADDR A:0x78b6414
y.create.l HWIO_BLSP1_BLSP_QUP2_QUP_CONFIG_ADDR A:0x78b7000
y.create.l HWIO_BLSP1_BLSP_QUP2_QUP_STATE_ADDR A:0x78b7004
y.create.l HWIO_BLSP1_BLSP_QUP2_QUP_IO_MODES_ADDR A:0x78b7008
y.create.l HWIO_BLSP1_BLSP_QUP2_QUP_SW_RESET_ADDR A:0x78b700c
y.create.l HWIO_BLSP1_BLSP_QUP2_QUP_TRANSFER_CANCEL_ADDR A:0x78b7014
y.create.l HWIO_BLSP1_BLSP_QUP2_QUP_OPERATIONAL_ADDR A:0x78b7018
y.create.l HWIO_BLSP1_BLSP_QUP2_QUP_ERROR_FLAGS_ADDR A:0x78b701c
y.create.l HWIO_BLSP1_BLSP_QUP2_QUP_ERROR_FLAGS_EN_ADDR A:0x78b7020
y.create.l HWIO_BLSP1_BLSP_QUP2_QUP_TEST_CTRL_ADDR A:0x78b7024
y.create.l HWIO_BLSP1_BLSP_QUP2_QUP_OPERATIONAL_MASK_ADDR A:0x78b7028
y.create.l HWIO_BLSP1_BLSP_QUP2_QUP_HW_VERSION_ADDR A:0x78b7030
y.create.l HWIO_BLSP1_BLSP_QUP2_QUP_MX_OUTPUT_COUNT_ADDR A:0x78b7100
y.create.l HWIO_BLSP1_BLSP_QUP2_QUP_MX_OUTPUT_CNT_CURRENT_ADDR A:0x78b7104
y.create.l HWIO_BLSP1_BLSP_QUP2_QUP_OUTPUT_DEBUG_ADDR A:0x78b7108
y.create.l HWIO_BLSP1_BLSP_QUP2_QUP_OUTPUT_FIFO_WORD_CNT_ADDR A:0x78b710c
y.create.l HWIO_BLSP1_BLSP_QUP2_QUP_OUTPUT_FIFO0_ADDR A:0x78b7110
y.create.l HWIO_BLSP1_BLSP_QUP2_QUP_OUTPUT_FIFO1_ADDR A:0x78b7114
y.create.l HWIO_BLSP1_BLSP_QUP2_QUP_OUTPUT_FIFO2_ADDR A:0x78b7118
y.create.l HWIO_BLSP1_BLSP_QUP2_QUP_OUTPUT_FIFO3_ADDR A:0x78b711c
y.create.l HWIO_BLSP1_BLSP_QUP2_QUP_OUTPUT_FIFO4_ADDR A:0x78b7120
y.create.l HWIO_BLSP1_BLSP_QUP2_QUP_OUTPUT_FIFO5_ADDR A:0x78b7124
y.create.l HWIO_BLSP1_BLSP_QUP2_QUP_OUTPUT_FIFO6_ADDR A:0x78b7128
y.create.l HWIO_BLSP1_BLSP_QUP2_QUP_OUTPUT_FIFO7_ADDR A:0x78b712c
y.create.l HWIO_BLSP1_BLSP_QUP2_QUP_OUTPUT_FIFO8_ADDR A:0x78b7130
y.create.l HWIO_BLSP1_BLSP_QUP2_QUP_OUTPUT_FIFO9_ADDR A:0x78b7134
y.create.l HWIO_BLSP1_BLSP_QUP2_QUP_MX_WRITE_COUNT_ADDR A:0x78b7150
y.create.l HWIO_BLSP1_BLSP_QUP2_QUP_MX_WRITE_CNT_CURRENT_ADDR A:0x78b7154
y.create.l HWIO_BLSP1_BLSP_QUP2_QUP_MX_INPUT_COUNT_ADDR A:0x78b7200
y.create.l HWIO_BLSP1_BLSP_QUP2_QUP_MX_INPUT_CNT_CURRENT_ADDR A:0x78b7204
y.create.l HWIO_BLSP1_BLSP_QUP2_QUP_MX_READ_COUNT_ADDR A:0x78b7208
y.create.l HWIO_BLSP1_BLSP_QUP2_QUP_MX_READ_CNT_CURRENT_ADDR A:0x78b720c
y.create.l HWIO_BLSP1_BLSP_QUP2_QUP_INPUT_DEBUG_ADDR A:0x78b7210
y.create.l HWIO_BLSP1_BLSP_QUP2_QUP_INPUT_FIFO_WORD_CNT_ADDR A:0x78b7214
y.create.l HWIO_BLSP1_BLSP_QUP2_QUP_INPUT_FIFO0_ADDR A:0x78b7218
y.create.l HWIO_BLSP1_BLSP_QUP2_QUP_INPUT_FIFO1_ADDR A:0x78b721c
y.create.l HWIO_BLSP1_BLSP_QUP2_QUP_INPUT_FIFO2_ADDR A:0x78b7220
y.create.l HWIO_BLSP1_BLSP_QUP2_QUP_INPUT_FIFO3_ADDR A:0x78b7224
y.create.l HWIO_BLSP1_BLSP_QUP2_QUP_INPUT_FIFO4_ADDR A:0x78b7228
y.create.l HWIO_BLSP1_BLSP_QUP2_QUP_INPUT_FIFO5_ADDR A:0x78b722c
y.create.l HWIO_BLSP1_BLSP_QUP2_QUP_INPUT_FIFO6_ADDR A:0x78b7230
y.create.l HWIO_BLSP1_BLSP_QUP2_QUP_INPUT_FIFO7_ADDR A:0x78b7234
y.create.l HWIO_BLSP1_BLSP_QUP2_QUP_INPUT_FIFO8_ADDR A:0x78b7238
y.create.l HWIO_BLSP1_BLSP_QUP2_QUP_INPUT_FIFO9_ADDR A:0x78b723c
y.create.l HWIO_BLSP1_BLSP_QUP2_SPI_CONFIG_ADDR A:0x78b7300
y.create.l HWIO_BLSP1_BLSP_QUP2_SPI_IO_CONTROL_ADDR A:0x78b7304
y.create.l HWIO_BLSP1_BLSP_QUP2_SPI_ERROR_FLAGS_ADDR A:0x78b7308
y.create.l HWIO_BLSP1_BLSP_QUP2_SPI_ERROR_FLAGS_EN_ADDR A:0x78b730c
y.create.l HWIO_BLSP1_BLSP_QUP2_SPI_DEASSERT_WAIT_ADDR A:0x78b7310
y.create.l HWIO_BLSP1_BLSP_QUP2_SPI_MASTER_LOCAL_ID_ADDR A:0x78b7314
y.create.l HWIO_BLSP1_BLSP_QUP2_SPI_MASTER_COMMAND_ADDR A:0x78b7318
y.create.l HWIO_BLSP1_BLSP_QUP2_SPI_MASTER_STATUS_ADDR A:0x78b731c
y.create.l HWIO_BLSP1_BLSP_QUP2_SPI_CHAR_CFG_ADDR A:0x78b7320
y.create.l HWIO_BLSP1_BLSP_QUP2_SPI_CHAR_DATA_SPI_CS_ADDR A:0x78b7324
y.create.l HWIO_BLSP1_BLSP_QUP2_SPI_CHAR_DATA_SPI_MOSI_ADDR A:0x78b7328
y.create.l HWIO_BLSP1_BLSP_QUP2_SPI_CHAR_DATA_SPI_MISO_ADDR A:0x78b732c
y.create.l HWIO_BLSP1_BLSP_QUP2_I2C_MASTER_CLK_CTL_ADDR A:0x78b7400
y.create.l HWIO_BLSP1_BLSP_QUP2_I2C_MASTER_STATUS_ADDR A:0x78b7404
y.create.l HWIO_BLSP1_BLSP_QUP2_I2C_MASTER_CONFIG_ADDR A:0x78b7408
y.create.l HWIO_BLSP1_BLSP_QUP2_I2C_MASTER_BUS_CLEAR_ADDR A:0x78b740c
y.create.l HWIO_BLSP1_BLSP_QUP2_I2C_MASTER_LOCAL_ID_ADDR A:0x78b7410
y.create.l HWIO_BLSP1_BLSP_QUP2_I2C_MASTER_COMMAND_ADDR A:0x78b7414
y.create.l HWIO_BLSP1_BLSP_QUP3_QUP_CONFIG_ADDR A:0x78b8000
y.create.l HWIO_BLSP1_BLSP_QUP3_QUP_STATE_ADDR A:0x78b8004
y.create.l HWIO_BLSP1_BLSP_QUP3_QUP_IO_MODES_ADDR A:0x78b8008
y.create.l HWIO_BLSP1_BLSP_QUP3_QUP_SW_RESET_ADDR A:0x78b800c
y.create.l HWIO_BLSP1_BLSP_QUP3_QUP_TRANSFER_CANCEL_ADDR A:0x78b8014
y.create.l HWIO_BLSP1_BLSP_QUP3_QUP_OPERATIONAL_ADDR A:0x78b8018
y.create.l HWIO_BLSP1_BLSP_QUP3_QUP_ERROR_FLAGS_ADDR A:0x78b801c
y.create.l HWIO_BLSP1_BLSP_QUP3_QUP_ERROR_FLAGS_EN_ADDR A:0x78b8020
y.create.l HWIO_BLSP1_BLSP_QUP3_QUP_TEST_CTRL_ADDR A:0x78b8024
y.create.l HWIO_BLSP1_BLSP_QUP3_QUP_OPERATIONAL_MASK_ADDR A:0x78b8028
y.create.l HWIO_BLSP1_BLSP_QUP3_QUP_HW_VERSION_ADDR A:0x78b8030
y.create.l HWIO_BLSP1_BLSP_QUP3_QUP_MX_OUTPUT_COUNT_ADDR A:0x78b8100
y.create.l HWIO_BLSP1_BLSP_QUP3_QUP_MX_OUTPUT_CNT_CURRENT_ADDR A:0x78b8104
y.create.l HWIO_BLSP1_BLSP_QUP3_QUP_OUTPUT_DEBUG_ADDR A:0x78b8108
y.create.l HWIO_BLSP1_BLSP_QUP3_QUP_OUTPUT_FIFO_WORD_CNT_ADDR A:0x78b810c
y.create.l HWIO_BLSP1_BLSP_QUP3_QUP_OUTPUT_FIFO0_ADDR A:0x78b8110
y.create.l HWIO_BLSP1_BLSP_QUP3_QUP_OUTPUT_FIFO1_ADDR A:0x78b8114
y.create.l HWIO_BLSP1_BLSP_QUP3_QUP_OUTPUT_FIFO2_ADDR A:0x78b8118
y.create.l HWIO_BLSP1_BLSP_QUP3_QUP_OUTPUT_FIFO3_ADDR A:0x78b811c
y.create.l HWIO_BLSP1_BLSP_QUP3_QUP_OUTPUT_FIFO4_ADDR A:0x78b8120
y.create.l HWIO_BLSP1_BLSP_QUP3_QUP_OUTPUT_FIFO5_ADDR A:0x78b8124
y.create.l HWIO_BLSP1_BLSP_QUP3_QUP_OUTPUT_FIFO6_ADDR A:0x78b8128
y.create.l HWIO_BLSP1_BLSP_QUP3_QUP_OUTPUT_FIFO7_ADDR A:0x78b812c
y.create.l HWIO_BLSP1_BLSP_QUP3_QUP_OUTPUT_FIFO8_ADDR A:0x78b8130
y.create.l HWIO_BLSP1_BLSP_QUP3_QUP_OUTPUT_FIFO9_ADDR A:0x78b8134
y.create.l HWIO_BLSP1_BLSP_QUP3_QUP_MX_WRITE_COUNT_ADDR A:0x78b8150
y.create.l HWIO_BLSP1_BLSP_QUP3_QUP_MX_WRITE_CNT_CURRENT_ADDR A:0x78b8154
y.create.l HWIO_BLSP1_BLSP_QUP3_QUP_MX_INPUT_COUNT_ADDR A:0x78b8200
y.create.l HWIO_BLSP1_BLSP_QUP3_QUP_MX_INPUT_CNT_CURRENT_ADDR A:0x78b8204
y.create.l HWIO_BLSP1_BLSP_QUP3_QUP_MX_READ_COUNT_ADDR A:0x78b8208
y.create.l HWIO_BLSP1_BLSP_QUP3_QUP_MX_READ_CNT_CURRENT_ADDR A:0x78b820c
y.create.l HWIO_BLSP1_BLSP_QUP3_QUP_INPUT_DEBUG_ADDR A:0x78b8210
y.create.l HWIO_BLSP1_BLSP_QUP3_QUP_INPUT_FIFO_WORD_CNT_ADDR A:0x78b8214
y.create.l HWIO_BLSP1_BLSP_QUP3_QUP_INPUT_FIFO0_ADDR A:0x78b8218
y.create.l HWIO_BLSP1_BLSP_QUP3_QUP_INPUT_FIFO1_ADDR A:0x78b821c
y.create.l HWIO_BLSP1_BLSP_QUP3_QUP_INPUT_FIFO2_ADDR A:0x78b8220
y.create.l HWIO_BLSP1_BLSP_QUP3_QUP_INPUT_FIFO3_ADDR A:0x78b8224
y.create.l HWIO_BLSP1_BLSP_QUP3_QUP_INPUT_FIFO4_ADDR A:0x78b8228
y.create.l HWIO_BLSP1_BLSP_QUP3_QUP_INPUT_FIFO5_ADDR A:0x78b822c
y.create.l HWIO_BLSP1_BLSP_QUP3_QUP_INPUT_FIFO6_ADDR A:0x78b8230
y.create.l HWIO_BLSP1_BLSP_QUP3_QUP_INPUT_FIFO7_ADDR A:0x78b8234
y.create.l HWIO_BLSP1_BLSP_QUP3_QUP_INPUT_FIFO8_ADDR A:0x78b8238
y.create.l HWIO_BLSP1_BLSP_QUP3_QUP_INPUT_FIFO9_ADDR A:0x78b823c
y.create.l HWIO_BLSP1_BLSP_QUP3_SPI_CONFIG_ADDR A:0x78b8300
y.create.l HWIO_BLSP1_BLSP_QUP3_SPI_IO_CONTROL_ADDR A:0x78b8304
y.create.l HWIO_BLSP1_BLSP_QUP3_SPI_ERROR_FLAGS_ADDR A:0x78b8308
y.create.l HWIO_BLSP1_BLSP_QUP3_SPI_ERROR_FLAGS_EN_ADDR A:0x78b830c
y.create.l HWIO_BLSP1_BLSP_QUP3_SPI_DEASSERT_WAIT_ADDR A:0x78b8310
y.create.l HWIO_BLSP1_BLSP_QUP3_SPI_MASTER_LOCAL_ID_ADDR A:0x78b8314
y.create.l HWIO_BLSP1_BLSP_QUP3_SPI_MASTER_COMMAND_ADDR A:0x78b8318
y.create.l HWIO_BLSP1_BLSP_QUP3_SPI_MASTER_STATUS_ADDR A:0x78b831c
y.create.l HWIO_BLSP1_BLSP_QUP3_SPI_CHAR_CFG_ADDR A:0x78b8320
y.create.l HWIO_BLSP1_BLSP_QUP3_SPI_CHAR_DATA_SPI_CS_ADDR A:0x78b8324
y.create.l HWIO_BLSP1_BLSP_QUP3_SPI_CHAR_DATA_SPI_MOSI_ADDR A:0x78b8328
y.create.l HWIO_BLSP1_BLSP_QUP3_SPI_CHAR_DATA_SPI_MISO_ADDR A:0x78b832c
y.create.l HWIO_BLSP1_BLSP_QUP3_I2C_MASTER_CLK_CTL_ADDR A:0x78b8400
y.create.l HWIO_BLSP1_BLSP_QUP3_I2C_MASTER_STATUS_ADDR A:0x78b8404
y.create.l HWIO_BLSP1_BLSP_QUP3_I2C_MASTER_CONFIG_ADDR A:0x78b8408
y.create.l HWIO_BLSP1_BLSP_QUP3_I2C_MASTER_BUS_CLEAR_ADDR A:0x78b840c
y.create.l HWIO_BLSP1_BLSP_QUP3_I2C_MASTER_LOCAL_ID_ADDR A:0x78b8410
y.create.l HWIO_BLSP1_BLSP_QUP3_I2C_MASTER_COMMAND_ADDR A:0x78b8414
y.create.l HWIO_BLSP1_BLSP_QUP4_QUP_CONFIG_ADDR A:0x78b9000
y.create.l HWIO_BLSP1_BLSP_QUP4_QUP_STATE_ADDR A:0x78b9004
y.create.l HWIO_BLSP1_BLSP_QUP4_QUP_IO_MODES_ADDR A:0x78b9008
y.create.l HWIO_BLSP1_BLSP_QUP4_QUP_SW_RESET_ADDR A:0x78b900c
y.create.l HWIO_BLSP1_BLSP_QUP4_QUP_TRANSFER_CANCEL_ADDR A:0x78b9014
y.create.l HWIO_BLSP1_BLSP_QUP4_QUP_OPERATIONAL_ADDR A:0x78b9018
y.create.l HWIO_BLSP1_BLSP_QUP4_QUP_ERROR_FLAGS_ADDR A:0x78b901c
y.create.l HWIO_BLSP1_BLSP_QUP4_QUP_ERROR_FLAGS_EN_ADDR A:0x78b9020
y.create.l HWIO_BLSP1_BLSP_QUP4_QUP_TEST_CTRL_ADDR A:0x78b9024
y.create.l HWIO_BLSP1_BLSP_QUP4_QUP_OPERATIONAL_MASK_ADDR A:0x78b9028
y.create.l HWIO_BLSP1_BLSP_QUP4_QUP_HW_VERSION_ADDR A:0x78b9030
y.create.l HWIO_BLSP1_BLSP_QUP4_QUP_MX_OUTPUT_COUNT_ADDR A:0x78b9100
y.create.l HWIO_BLSP1_BLSP_QUP4_QUP_MX_OUTPUT_CNT_CURRENT_ADDR A:0x78b9104
y.create.l HWIO_BLSP1_BLSP_QUP4_QUP_OUTPUT_DEBUG_ADDR A:0x78b9108
y.create.l HWIO_BLSP1_BLSP_QUP4_QUP_OUTPUT_FIFO_WORD_CNT_ADDR A:0x78b910c
y.create.l HWIO_BLSP1_BLSP_QUP4_QUP_OUTPUT_FIFO0_ADDR A:0x78b9110
y.create.l HWIO_BLSP1_BLSP_QUP4_QUP_OUTPUT_FIFO1_ADDR A:0x78b9114
y.create.l HWIO_BLSP1_BLSP_QUP4_QUP_OUTPUT_FIFO2_ADDR A:0x78b9118
y.create.l HWIO_BLSP1_BLSP_QUP4_QUP_OUTPUT_FIFO3_ADDR A:0x78b911c
y.create.l HWIO_BLSP1_BLSP_QUP4_QUP_OUTPUT_FIFO4_ADDR A:0x78b9120
y.create.l HWIO_BLSP1_BLSP_QUP4_QUP_OUTPUT_FIFO5_ADDR A:0x78b9124
y.create.l HWIO_BLSP1_BLSP_QUP4_QUP_OUTPUT_FIFO6_ADDR A:0x78b9128
y.create.l HWIO_BLSP1_BLSP_QUP4_QUP_OUTPUT_FIFO7_ADDR A:0x78b912c
y.create.l HWIO_BLSP1_BLSP_QUP4_QUP_OUTPUT_FIFO8_ADDR A:0x78b9130
y.create.l HWIO_BLSP1_BLSP_QUP4_QUP_OUTPUT_FIFO9_ADDR A:0x78b9134
y.create.l HWIO_BLSP1_BLSP_QUP4_QUP_MX_WRITE_COUNT_ADDR A:0x78b9150
y.create.l HWIO_BLSP1_BLSP_QUP4_QUP_MX_WRITE_CNT_CURRENT_ADDR A:0x78b9154
y.create.l HWIO_BLSP1_BLSP_QUP4_QUP_MX_INPUT_COUNT_ADDR A:0x78b9200
y.create.l HWIO_BLSP1_BLSP_QUP4_QUP_MX_INPUT_CNT_CURRENT_ADDR A:0x78b9204
y.create.l HWIO_BLSP1_BLSP_QUP4_QUP_MX_READ_COUNT_ADDR A:0x78b9208
y.create.l HWIO_BLSP1_BLSP_QUP4_QUP_MX_READ_CNT_CURRENT_ADDR A:0x78b920c
y.create.l HWIO_BLSP1_BLSP_QUP4_QUP_INPUT_DEBUG_ADDR A:0x78b9210
y.create.l HWIO_BLSP1_BLSP_QUP4_QUP_INPUT_FIFO_WORD_CNT_ADDR A:0x78b9214
y.create.l HWIO_BLSP1_BLSP_QUP4_QUP_INPUT_FIFO0_ADDR A:0x78b9218
y.create.l HWIO_BLSP1_BLSP_QUP4_QUP_INPUT_FIFO1_ADDR A:0x78b921c
y.create.l HWIO_BLSP1_BLSP_QUP4_QUP_INPUT_FIFO2_ADDR A:0x78b9220
y.create.l HWIO_BLSP1_BLSP_QUP4_QUP_INPUT_FIFO3_ADDR A:0x78b9224
y.create.l HWIO_BLSP1_BLSP_QUP4_QUP_INPUT_FIFO4_ADDR A:0x78b9228
y.create.l HWIO_BLSP1_BLSP_QUP4_QUP_INPUT_FIFO5_ADDR A:0x78b922c
y.create.l HWIO_BLSP1_BLSP_QUP4_QUP_INPUT_FIFO6_ADDR A:0x78b9230
y.create.l HWIO_BLSP1_BLSP_QUP4_QUP_INPUT_FIFO7_ADDR A:0x78b9234
y.create.l HWIO_BLSP1_BLSP_QUP4_QUP_INPUT_FIFO8_ADDR A:0x78b9238
y.create.l HWIO_BLSP1_BLSP_QUP4_QUP_INPUT_FIFO9_ADDR A:0x78b923c
y.create.l HWIO_BLSP1_BLSP_QUP4_SPI_CONFIG_ADDR A:0x78b9300
y.create.l HWIO_BLSP1_BLSP_QUP4_SPI_IO_CONTROL_ADDR A:0x78b9304
y.create.l HWIO_BLSP1_BLSP_QUP4_SPI_ERROR_FLAGS_ADDR A:0x78b9308
y.create.l HWIO_BLSP1_BLSP_QUP4_SPI_ERROR_FLAGS_EN_ADDR A:0x78b930c
y.create.l HWIO_BLSP1_BLSP_QUP4_SPI_DEASSERT_WAIT_ADDR A:0x78b9310
y.create.l HWIO_BLSP1_BLSP_QUP4_SPI_MASTER_LOCAL_ID_ADDR A:0x78b9314
y.create.l HWIO_BLSP1_BLSP_QUP4_SPI_MASTER_COMMAND_ADDR A:0x78b9318
y.create.l HWIO_BLSP1_BLSP_QUP4_SPI_MASTER_STATUS_ADDR A:0x78b931c
y.create.l HWIO_BLSP1_BLSP_QUP4_SPI_CHAR_CFG_ADDR A:0x78b9320
y.create.l HWIO_BLSP1_BLSP_QUP4_SPI_CHAR_DATA_SPI_CS_ADDR A:0x78b9324
y.create.l HWIO_BLSP1_BLSP_QUP4_SPI_CHAR_DATA_SPI_MOSI_ADDR A:0x78b9328
y.create.l HWIO_BLSP1_BLSP_QUP4_SPI_CHAR_DATA_SPI_MISO_ADDR A:0x78b932c
y.create.l HWIO_BLSP1_BLSP_QUP4_I2C_MASTER_CLK_CTL_ADDR A:0x78b9400
y.create.l HWIO_BLSP1_BLSP_QUP4_I2C_MASTER_STATUS_ADDR A:0x78b9404
y.create.l HWIO_BLSP1_BLSP_QUP4_I2C_MASTER_CONFIG_ADDR A:0x78b9408
y.create.l HWIO_BLSP1_BLSP_QUP4_I2C_MASTER_BUS_CLEAR_ADDR A:0x78b940c
y.create.l HWIO_BLSP1_BLSP_QUP4_I2C_MASTER_LOCAL_ID_ADDR A:0x78b9410
y.create.l HWIO_BLSP1_BLSP_QUP4_I2C_MASTER_COMMAND_ADDR A:0x78b9414
y.create.l HWIO_BLSP1_BLSP_QUP5_QUP_CONFIG_ADDR A:0x78ba000
y.create.l HWIO_BLSP1_BLSP_QUP5_QUP_STATE_ADDR A:0x78ba004
y.create.l HWIO_BLSP1_BLSP_QUP5_QUP_IO_MODES_ADDR A:0x78ba008
y.create.l HWIO_BLSP1_BLSP_QUP5_QUP_SW_RESET_ADDR A:0x78ba00c
y.create.l HWIO_BLSP1_BLSP_QUP5_QUP_TRANSFER_CANCEL_ADDR A:0x78ba014
y.create.l HWIO_BLSP1_BLSP_QUP5_QUP_OPERATIONAL_ADDR A:0x78ba018
y.create.l HWIO_BLSP1_BLSP_QUP5_QUP_ERROR_FLAGS_ADDR A:0x78ba01c
y.create.l HWIO_BLSP1_BLSP_QUP5_QUP_ERROR_FLAGS_EN_ADDR A:0x78ba020
y.create.l HWIO_BLSP1_BLSP_QUP5_QUP_TEST_CTRL_ADDR A:0x78ba024
y.create.l HWIO_BLSP1_BLSP_QUP5_QUP_OPERATIONAL_MASK_ADDR A:0x78ba028
y.create.l HWIO_BLSP1_BLSP_QUP5_QUP_HW_VERSION_ADDR A:0x78ba030
y.create.l HWIO_BLSP1_BLSP_QUP5_QUP_MX_OUTPUT_COUNT_ADDR A:0x78ba100
y.create.l HWIO_BLSP1_BLSP_QUP5_QUP_MX_OUTPUT_CNT_CURRENT_ADDR A:0x78ba104
y.create.l HWIO_BLSP1_BLSP_QUP5_QUP_OUTPUT_DEBUG_ADDR A:0x78ba108
y.create.l HWIO_BLSP1_BLSP_QUP5_QUP_OUTPUT_FIFO_WORD_CNT_ADDR A:0x78ba10c
y.create.l HWIO_BLSP1_BLSP_QUP5_QUP_OUTPUT_FIFO0_ADDR A:0x78ba110
y.create.l HWIO_BLSP1_BLSP_QUP5_QUP_OUTPUT_FIFO1_ADDR A:0x78ba114
y.create.l HWIO_BLSP1_BLSP_QUP5_QUP_OUTPUT_FIFO2_ADDR A:0x78ba118
y.create.l HWIO_BLSP1_BLSP_QUP5_QUP_OUTPUT_FIFO3_ADDR A:0x78ba11c
y.create.l HWIO_BLSP1_BLSP_QUP5_QUP_OUTPUT_FIFO4_ADDR A:0x78ba120
y.create.l HWIO_BLSP1_BLSP_QUP5_QUP_OUTPUT_FIFO5_ADDR A:0x78ba124
y.create.l HWIO_BLSP1_BLSP_QUP5_QUP_OUTPUT_FIFO6_ADDR A:0x78ba128
y.create.l HWIO_BLSP1_BLSP_QUP5_QUP_OUTPUT_FIFO7_ADDR A:0x78ba12c
y.create.l HWIO_BLSP1_BLSP_QUP5_QUP_OUTPUT_FIFO8_ADDR A:0x78ba130
y.create.l HWIO_BLSP1_BLSP_QUP5_QUP_OUTPUT_FIFO9_ADDR A:0x78ba134
y.create.l HWIO_BLSP1_BLSP_QUP5_QUP_MX_WRITE_COUNT_ADDR A:0x78ba150
y.create.l HWIO_BLSP1_BLSP_QUP5_QUP_MX_WRITE_CNT_CURRENT_ADDR A:0x78ba154
y.create.l HWIO_BLSP1_BLSP_QUP5_QUP_MX_INPUT_COUNT_ADDR A:0x78ba200
y.create.l HWIO_BLSP1_BLSP_QUP5_QUP_MX_INPUT_CNT_CURRENT_ADDR A:0x78ba204
y.create.l HWIO_BLSP1_BLSP_QUP5_QUP_MX_READ_COUNT_ADDR A:0x78ba208
y.create.l HWIO_BLSP1_BLSP_QUP5_QUP_MX_READ_CNT_CURRENT_ADDR A:0x78ba20c
y.create.l HWIO_BLSP1_BLSP_QUP5_QUP_INPUT_DEBUG_ADDR A:0x78ba210
y.create.l HWIO_BLSP1_BLSP_QUP5_QUP_INPUT_FIFO_WORD_CNT_ADDR A:0x78ba214
y.create.l HWIO_BLSP1_BLSP_QUP5_QUP_INPUT_FIFO0_ADDR A:0x78ba218
y.create.l HWIO_BLSP1_BLSP_QUP5_QUP_INPUT_FIFO1_ADDR A:0x78ba21c
y.create.l HWIO_BLSP1_BLSP_QUP5_QUP_INPUT_FIFO2_ADDR A:0x78ba220
y.create.l HWIO_BLSP1_BLSP_QUP5_QUP_INPUT_FIFO3_ADDR A:0x78ba224
y.create.l HWIO_BLSP1_BLSP_QUP5_QUP_INPUT_FIFO4_ADDR A:0x78ba228
y.create.l HWIO_BLSP1_BLSP_QUP5_QUP_INPUT_FIFO5_ADDR A:0x78ba22c
y.create.l HWIO_BLSP1_BLSP_QUP5_QUP_INPUT_FIFO6_ADDR A:0x78ba230
y.create.l HWIO_BLSP1_BLSP_QUP5_QUP_INPUT_FIFO7_ADDR A:0x78ba234
y.create.l HWIO_BLSP1_BLSP_QUP5_QUP_INPUT_FIFO8_ADDR A:0x78ba238
y.create.l HWIO_BLSP1_BLSP_QUP5_QUP_INPUT_FIFO9_ADDR A:0x78ba23c
y.create.l HWIO_BLSP1_BLSP_QUP5_SPI_CONFIG_ADDR A:0x78ba300
y.create.l HWIO_BLSP1_BLSP_QUP5_SPI_IO_CONTROL_ADDR A:0x78ba304
y.create.l HWIO_BLSP1_BLSP_QUP5_SPI_ERROR_FLAGS_ADDR A:0x78ba308
y.create.l HWIO_BLSP1_BLSP_QUP5_SPI_ERROR_FLAGS_EN_ADDR A:0x78ba30c
y.create.l HWIO_BLSP1_BLSP_QUP5_SPI_DEASSERT_WAIT_ADDR A:0x78ba310
y.create.l HWIO_BLSP1_BLSP_QUP5_SPI_MASTER_LOCAL_ID_ADDR A:0x78ba314
y.create.l HWIO_BLSP1_BLSP_QUP5_SPI_MASTER_COMMAND_ADDR A:0x78ba318
y.create.l HWIO_BLSP1_BLSP_QUP5_SPI_MASTER_STATUS_ADDR A:0x78ba31c
y.create.l HWIO_BLSP1_BLSP_QUP5_SPI_CHAR_CFG_ADDR A:0x78ba320
y.create.l HWIO_BLSP1_BLSP_QUP5_SPI_CHAR_DATA_SPI_CS_ADDR A:0x78ba324
y.create.l HWIO_BLSP1_BLSP_QUP5_SPI_CHAR_DATA_SPI_MOSI_ADDR A:0x78ba328
y.create.l HWIO_BLSP1_BLSP_QUP5_SPI_CHAR_DATA_SPI_MISO_ADDR A:0x78ba32c
y.create.l HWIO_BLSP1_BLSP_QUP5_I2C_MASTER_CLK_CTL_ADDR A:0x78ba400
y.create.l HWIO_BLSP1_BLSP_QUP5_I2C_MASTER_STATUS_ADDR A:0x78ba404
y.create.l HWIO_BLSP1_BLSP_QUP5_I2C_MASTER_CONFIG_ADDR A:0x78ba408
y.create.l HWIO_BLSP1_BLSP_QUP5_I2C_MASTER_BUS_CLEAR_ADDR A:0x78ba40c
y.create.l HWIO_BLSP1_BLSP_QUP5_I2C_MASTER_LOCAL_ID_ADDR A:0x78ba410
y.create.l HWIO_BLSP1_BLSP_QUP5_I2C_MASTER_COMMAND_ADDR A:0x78ba414
y.create.l HWIO_BOOT_ROM_XPU_SCR_ADDR A:0x1ff000
y.create.l HWIO_BOOT_ROM_XPU_SWDR_ADDR A:0x1ff004
y.create.l HWIO_BOOT_ROM_XPU_PRTN_RACR_SSHADOW_ADDR A:0x1ff008
y.create.l HWIO_BOOT_ROM_XPU_PRTN_START_SSHADOW0_ADDR A:0x1ff010
y.create.l HWIO_BOOT_ROM_XPU_PRTN_END_SSHADOW0_ADDR A:0x1ff018
y.create.l HWIO_BOOT_ROM_XPU_SEAR0_ADDR A:0x1ff040
y.create.l HWIO_BOOT_ROM_XPU_SESR_ADDR A:0x1ff048
y.create.l HWIO_BOOT_ROM_XPU_SESRRESTORE_ADDR A:0x1ff04c
y.create.l HWIO_BOOT_ROM_XPU_SESYNR0_ADDR A:0x1ff050
y.create.l HWIO_BOOT_ROM_XPU_SESYNR1_ADDR A:0x1ff054
y.create.l HWIO_BOOT_ROM_XPU_SESYNR2_ADDR A:0x1ff058
y.create.l HWIO_BOOT_ROM_XPU_MCR_ADDR A:0x1ff100
y.create.l HWIO_BOOT_ROM_XPU_MEAR0_ADDR A:0x1ff140
y.create.l HWIO_BOOT_ROM_XPU_MESR_ADDR A:0x1ff148
y.create.l HWIO_BOOT_ROM_XPU_MESRRESTORE_ADDR A:0x1ff14c
y.create.l HWIO_BOOT_ROM_XPU_MESYNR0_ADDR A:0x1ff150
y.create.l HWIO_BOOT_ROM_XPU_MESYNR1_ADDR A:0x1ff154
y.create.l HWIO_BOOT_ROM_XPU_MESYNR2_ADDR A:0x1ff158
y.create.l HWIO_BOOT_ROM_XPU_CR_ADDR A:0x1ff080
y.create.l HWIO_BOOT_ROM_XPU_PRTN_RACR_SHADOW_ADDR A:0x1ff088
y.create.l HWIO_BOOT_ROM_XPU_PRTN_START_SHADOW0_ADDR A:0x1ff090
y.create.l HWIO_BOOT_ROM_XPU_PRTN_END_SHADOW0_ADDR A:0x1ff098
y.create.l HWIO_BOOT_ROM_XPU_RPU_ACR0_ADDR A:0x1ff0a0
y.create.l HWIO_BOOT_ROM_XPU_EAR0_ADDR A:0x1ff0c0
y.create.l HWIO_BOOT_ROM_XPU_ESR_ADDR A:0x1ff0c8
y.create.l HWIO_BOOT_ROM_XPU_ESRRESTORE_ADDR A:0x1ff0cc
y.create.l HWIO_BOOT_ROM_XPU_ESYNR0_ADDR A:0x1ff0d0
y.create.l HWIO_BOOT_ROM_XPU_ESYNR1_ADDR A:0x1ff0d4
y.create.l HWIO_BOOT_ROM_XPU_ESYNR2_ADDR A:0x1ff0d8
y.create.l HWIO_BOOT_ROM_XPU_UMR_RACR_ADDR A:0x1ff0e0
y.create.l HWIO_BOOT_ROM_XPU_UMR_WACR_ADDR A:0x1ff0e4
y.create.l HWIO_BOOT_ROM_XPU_UMR_CNTL_ADDR A:0x1ff0f0
y.create.l HWIO_BOOT_ROM_XPU_IDR0_ADDR A:0x1ff074
y.create.l HWIO_BOOT_ROM_XPU_IDR1_ADDR A:0x1ff078
y.create.l HWIO_BOOT_ROM_XPU_REV_ADDR A:0x1ff07c
y.create.l HWIO_BOOT_ROM_XPU_PRT0_RACR0_ADDR A:0x1ff200
y.create.l HWIO_BOOT_ROM_XPU_PRT1_RACR0_ADDR A:0x1ff280
y.create.l HWIO_BOOT_ROM_XPU_PRT2_RACR0_ADDR A:0x1ff300
y.create.l HWIO_BOOT_ROM_XPU_PRT0_START0_ADDR A:0x1ff240
y.create.l HWIO_BOOT_ROM_XPU_PRT1_START0_ADDR A:0x1ff2c0
y.create.l HWIO_BOOT_ROM_XPU_PRT2_START0_ADDR A:0x1ff340
y.create.l HWIO_BOOT_ROM_XPU_PRT0_END0_ADDR A:0x1ff248
y.create.l HWIO_BOOT_ROM_XPU_PRT1_END0_ADDR A:0x1ff2c8
y.create.l HWIO_BOOT_ROM_XPU_PRT2_END0_ADDR A:0x1ff348
y.create.l HWIO_BOOT_ROM_XPU_PRT0_SCR_ADDR A:0x1ff250
y.create.l HWIO_BOOT_ROM_XPU_PRT1_SCR_ADDR A:0x1ff2d0
y.create.l HWIO_BOOT_ROM_XPU_PRT2_SCR_ADDR A:0x1ff350
y.create.l HWIO_BOOT_ROM_XPU_PRT0_MCR_ADDR A:0x1ff254
y.create.l HWIO_BOOT_ROM_XPU_PRT1_MCR_ADDR A:0x1ff2d4
y.create.l HWIO_BOOT_ROM_XPU_PRT2_MCR_ADDR A:0x1ff354
y.create.l HWIO_BOOT_ROM_XPU_PRT0_CNTL0_ADDR A:0x1ff258
y.create.l HWIO_BOOT_ROM_XPU_PRT1_CNTL0_ADDR A:0x1ff2d8
y.create.l HWIO_BOOT_ROM_XPU_PRT2_CNTL0_ADDR A:0x1ff358
y.create.l HWIO_BOOT_ROM_XPU_PRT0_CNTL1_ADDR A:0x1ff25c
y.create.l HWIO_BOOT_ROM_XPU_PRT1_CNTL1_ADDR A:0x1ff2dc
y.create.l HWIO_BOOT_ROM_XPU_PRT2_CNTL1_ADDR A:0x1ff35c
y.create.l HWIO_CAMSS_A_CAMSS_HW_VERSION_ADDR A:0x1b00000
y.create.l HWIO_CAMSS_A_CAMSS_TESTBUS_SEL_ADDR A:0x1b00004
y.create.l HWIO_CAMSS_A_CAMSS_GPIO_MUX_SEL_ADDR A:0x1b00008
y.create.l HWIO_CAMSS_A_CAMSS_AHB_ARB_CTL_ADDR A:0x1b0000c
y.create.l HWIO_CAMSS_A_CAMSS_XPU2_STATUS_ADDR A:0x1b00010
y.create.l HWIO_CAMSS_A_CAMSS_CSI_PIX_CLK_MUX_SEL_ADDR A:0x1b00020
y.create.l HWIO_CAMSS_A_CAMSS_CSI_PIX_CLK_CGC_EN_ADDR A:0x1b00024
y.create.l HWIO_CAMSS_A_CAMSS_CSI_RDI_CLK_MUX_SEL_ADDR A:0x1b00028
y.create.l HWIO_CAMSS_A_CAMSS_CSI_RDI_CLK_CGC_EN_ADDR A:0x1b0002c
y.create.l HWIO_CAMSS_A_CAMSS_CSI_PHY_0_CLK_MUX_SEL_ADDR A:0x1b00030
y.create.l HWIO_CAMSS_A_CAMSS_CSI_PHY_0_CLK_CGC_EN_ADDR A:0x1b00034
y.create.l HWIO_CAMSS_A_CAMSS_CSI_PHY_1_CLK_MUX_SEL_ADDR A:0x1b00038
y.create.l HWIO_CAMSS_A_CAMSS_CSI_PHY_1_CLK_CGC_EN_ADDR A:0x1b0003c
y.create.l HWIO_CAMSS_A_CAMSS_CSI_PHY_2_CLK_MUX_SEL_ADDR A:0x1b00040
y.create.l HWIO_CAMSS_A_CAMSS_CSI_PHY_2_CLK_CGC_EN_ADDR A:0x1b00044
y.create.l HWIO_CAMSS_A_CAMSS_JPEG_FORCE_CLK_ON_ADDR A:0x1b00050
y.create.l HWIO_CAMSS_A_CAMSS_CPP_FORCE_CLK_ON_ADDR A:0x1b00054
y.create.l HWIO_CAMSS_A_CAMSS_VFE_FORCE_CLK_ON_ADDR A:0x1b00058
y.create.l HWIO_CAMSS_A_CAMSS_CCI_FORCE_CLK_ON_ADDR A:0x1b0005c
y.create.l HWIO_CAMSS_A_CAMSS_IRQ_COMPOSITE_RESET_CTRL_ADDR A:0x1b00060
y.create.l HWIO_CAMSS_A_CAMSS_IRQ_COMPOSITE_MASK_0_ADDR A:0x1b00064
y.create.l HWIO_CAMSS_A_CAMSS_IRQ_COMPOSITE_MASK_1_ADDR A:0x1b00068
y.create.l HWIO_CAMSS_A_CAMSS_IRQ_COMPOSITE_MASK_2_ADDR A:0x1b0006c
y.create.l HWIO_CAMSS_A_CAMSS_IRQ_COMPOSITE_MASK_3_ADDR A:0x1b00070
y.create.l HWIO_CAMSS_A_CAMSS_IRQ_COMPOSITE_MASK_4_ADDR A:0x1b00074
y.create.l HWIO_CAMSS_A_CAMSS_IRQ_COMPOSITE_MASK_5_ADDR A:0x1b00078
y.create.l HWIO_CAMSS_A_CAMSS_IRQ_COMPOSITE_MASK_6_ADDR A:0x1b0007c
y.create.l HWIO_CAMSS_A_CAMSS_IRQ_COMPOSITE_MASK_7_ADDR A:0x1b00080
y.create.l HWIO_CAMSS_A_CAMSS_IRQ_COMPOSITE_MASK_8_ADDR A:0x1b00084
y.create.l HWIO_CAMSS_A_CAMSS_IRQ_COMPOSITE_MASK_9_ADDR A:0x1b00088
y.create.l HWIO_CAMSS_A_CAMSS_IRQ_COMPOSITE_MASK_10_ADDR A:0x1b0008c
y.create.l HWIO_CAMSS_A_CAMSS_IRQ_COMPOSITE_MASK_11_ADDR A:0x1b00090
y.create.l HWIO_CAMSS_A_CAMSS_IRQ_COMPOSITE_MASK_12_ADDR A:0x1b00094
y.create.l HWIO_CAMSS_A_CAMSS_IRQ_COMPOSITE_MICRO_MASK_0_ADDR A:0x1b000a4
y.create.l HWIO_CAMSS_A_CAMSS_IRQ_COMPOSITE_MICRO_MASK_1_ADDR A:0x1b000a8
y.create.l HWIO_CAMSS_A_CAMSS_IRQ_COMPOSITE_MICRO_MASK_2_ADDR A:0x1b000ac
y.create.l HWIO_CAMSS_A_CAMSS_IRQ_COMPOSITE_MICRO_MASK_3_ADDR A:0x1b000b0
y.create.l HWIO_CAMSS_A_CAMSS_IRQ_COMPOSITE_MICRO_MASK_4_ADDR A:0x1b000b4
y.create.l HWIO_CAMSS_A_CAMSS_IRQ_COMPOSITE_MICRO_MASK_5_ADDR A:0x1b000b8
y.create.l HWIO_CAMSS_A_CAMSS_SPARE_ADDR A:0x1b000fc
y.create.l HWIO_CAMSS_A_CSID_0_CSID_HW_VERSION_ADDR A:0x1b08000
y.create.l HWIO_CAMSS_A_CSID_0_CSID_CORE_CTRL_0_ADDR A:0x1b08004
y.create.l HWIO_CAMSS_A_CSID_0_CSID_CORE_CTRL_1_ADDR A:0x1b08008
y.create.l HWIO_CAMSS_A_CSID_0_CSID_RST_CMD_ADDR A:0x1b0800c
y.create.l HWIO_CAMSS_A_CSID_0_CSID_CID_LUT_VC_0_ADDR A:0x1b08010
y.create.l HWIO_CAMSS_A_CSID_0_CSID_CID_LUT_VC_1_ADDR A:0x1b08014
y.create.l HWIO_CAMSS_A_CSID_0_CSID_CID_LUT_VC_2_ADDR A:0x1b08018
y.create.l HWIO_CAMSS_A_CSID_0_CSID_CID_LUT_VC_3_ADDR A:0x1b0801c
y.create.l HWIO_CAMSS_A_CSID_0_CSID_CID_0_CFG_ADDR A:0x1b08020
y.create.l HWIO_CAMSS_A_CSID_0_CSID_CID_1_CFG_ADDR A:0x1b08024
y.create.l HWIO_CAMSS_A_CSID_0_CSID_CID_2_CFG_ADDR A:0x1b08028
y.create.l HWIO_CAMSS_A_CSID_0_CSID_CID_3_CFG_ADDR A:0x1b0802c
y.create.l HWIO_CAMSS_A_CSID_0_CSID_CID_4_CFG_ADDR A:0x1b08030
y.create.l HWIO_CAMSS_A_CSID_0_CSID_CID_5_CFG_ADDR A:0x1b08034
y.create.l HWIO_CAMSS_A_CSID_0_CSID_CID_6_CFG_ADDR A:0x1b08038
y.create.l HWIO_CAMSS_A_CSID_0_CSID_CID_7_CFG_ADDR A:0x1b0803c
y.create.l HWIO_CAMSS_A_CSID_0_CSID_CID_8_CFG_ADDR A:0x1b08040
y.create.l HWIO_CAMSS_A_CSID_0_CSID_CID_9_CFG_ADDR A:0x1b08044
y.create.l HWIO_CAMSS_A_CSID_0_CSID_IRQ_CLEAR_CMD_ADDR A:0x1b08060
y.create.l HWIO_CAMSS_A_CSID_0_CSID_IRQ_MASK_ADDR A:0x1b08064
y.create.l HWIO_CAMSS_A_CSID_0_CSID_IRQ_STATUS_ADDR A:0x1b08068
y.create.l HWIO_CAMSS_A_CSID_0_CSID_CAPTURED_UNMAPPED_LONG_PKT_HDR_ADDR A:0x1b0806c
y.create.l HWIO_CAMSS_A_CSID_0_CSID_CAPTURED_MMAPPED_LONG_PKT_HDR_ADDR A:0x1b08070
y.create.l HWIO_CAMSS_A_CSID_0_CSID_CAPTURED_SHORT_PKT_ADDR A:0x1b08074
y.create.l HWIO_CAMSS_A_CSID_0_CSID_CAPTURED_LONG_PKT_HDR_ADDR A:0x1b08078
y.create.l HWIO_CAMSS_A_CSID_0_CSID_CAPTURED_LONG_PKT_FTR_ADDR A:0x1b0807c
y.create.l HWIO_CAMSS_A_CSID_0_CSID_PIF_MISR_DL0_ADDR A:0x1b08080
y.create.l HWIO_CAMSS_A_CSID_0_CSID_PIF_MISR_DL1_ADDR A:0x1b08084
y.create.l HWIO_CAMSS_A_CSID_0_CSID_PIF_MISR_DL2_ADDR A:0x1b08088
y.create.l HWIO_CAMSS_A_CSID_0_CSID_PIF_MISR_DL3_ADDR A:0x1b0808c
y.create.l HWIO_CAMSS_A_CSID_0_CSID_STATS_TOTAL_PKTS_RCVD_ADDR A:0x1b08090
y.create.l HWIO_CAMSS_A_CSID_0_CSID_STATS_ECC_ADDR A:0x1b08094
y.create.l HWIO_CAMSS_A_CSID_0_CSID_STATS_CRC_ADDR A:0x1b08098
y.create.l HWIO_CAMSS_A_CSID_0_CSID_TEST_BUS_CTRL_ADDR A:0x1b0809c
y.create.l HWIO_CAMSS_A_CSID_0_CSID_TG_CTRL_ADDR A:0x1b080a0
y.create.l HWIO_CAMSS_A_CSID_0_CSID_TG_VC_CFG_ADDR A:0x1b080a4
y.create.l HWIO_CAMSS_A_CSID_0_CSID_TG_PAYLOAD_LFSR_SEED_ADDR A:0x1b080a8
y.create.l HWIO_CAMSS_A_CSID_0_CSID_TG_DT_0_CFG_0_ADDR A:0x1b080ac
y.create.l HWIO_CAMSS_A_CSID_0_CSID_TG_DT_1_CFG_0_ADDR A:0x1b080b8
y.create.l HWIO_CAMSS_A_CSID_0_CSID_TG_DT_2_CFG_0_ADDR A:0x1b080c4
y.create.l HWIO_CAMSS_A_CSID_0_CSID_TG_DT_3_CFG_0_ADDR A:0x1b080d0
y.create.l HWIO_CAMSS_A_CSID_0_CSID_TG_DT_0_CFG_1_ADDR A:0x1b080b0
y.create.l HWIO_CAMSS_A_CSID_0_CSID_TG_DT_1_CFG_1_ADDR A:0x1b080bc
y.create.l HWIO_CAMSS_A_CSID_0_CSID_TG_DT_2_CFG_1_ADDR A:0x1b080c8
y.create.l HWIO_CAMSS_A_CSID_0_CSID_TG_DT_3_CFG_1_ADDR A:0x1b080d4
y.create.l HWIO_CAMSS_A_CSID_0_CSID_TG_DT_0_CFG_2_ADDR A:0x1b080b4
y.create.l HWIO_CAMSS_A_CSID_0_CSID_TG_DT_1_CFG_2_ADDR A:0x1b080c0
y.create.l HWIO_CAMSS_A_CSID_0_CSID_TG_DT_2_CFG_2_ADDR A:0x1b080cc
y.create.l HWIO_CAMSS_A_CSID_0_CSID_TG_DT_3_CFG_2_ADDR A:0x1b080d8
y.create.l HWIO_CAMSS_A_CSID_0_CSID_SPARE_0_ADDR A:0x1b080dc
y.create.l HWIO_CAMSS_A_CSID_0_CSID_SPARE_1_ADDR A:0x1b080e0
y.create.l HWIO_CAMSS_A_CSID_1_CSID_HW_VERSION_ADDR A:0x1b08400
y.create.l HWIO_CAMSS_A_CSID_1_CSID_CORE_CTRL_0_ADDR A:0x1b08404
y.create.l HWIO_CAMSS_A_CSID_1_CSID_CORE_CTRL_1_ADDR A:0x1b08408
y.create.l HWIO_CAMSS_A_CSID_1_CSID_RST_CMD_ADDR A:0x1b0840c
y.create.l HWIO_CAMSS_A_CSID_1_CSID_CID_LUT_VC_0_ADDR A:0x1b08410
y.create.l HWIO_CAMSS_A_CSID_1_CSID_CID_LUT_VC_1_ADDR A:0x1b08414
y.create.l HWIO_CAMSS_A_CSID_1_CSID_CID_LUT_VC_2_ADDR A:0x1b08418
y.create.l HWIO_CAMSS_A_CSID_1_CSID_CID_LUT_VC_3_ADDR A:0x1b0841c
y.create.l HWIO_CAMSS_A_CSID_1_CSID_CID_0_CFG_ADDR A:0x1b08420
y.create.l HWIO_CAMSS_A_CSID_1_CSID_CID_1_CFG_ADDR A:0x1b08424
y.create.l HWIO_CAMSS_A_CSID_1_CSID_CID_2_CFG_ADDR A:0x1b08428
y.create.l HWIO_CAMSS_A_CSID_1_CSID_CID_3_CFG_ADDR A:0x1b0842c
y.create.l HWIO_CAMSS_A_CSID_1_CSID_CID_4_CFG_ADDR A:0x1b08430
y.create.l HWIO_CAMSS_A_CSID_1_CSID_CID_5_CFG_ADDR A:0x1b08434
y.create.l HWIO_CAMSS_A_CSID_1_CSID_CID_6_CFG_ADDR A:0x1b08438
y.create.l HWIO_CAMSS_A_CSID_1_CSID_CID_7_CFG_ADDR A:0x1b0843c
y.create.l HWIO_CAMSS_A_CSID_1_CSID_CID_8_CFG_ADDR A:0x1b08440
y.create.l HWIO_CAMSS_A_CSID_1_CSID_CID_9_CFG_ADDR A:0x1b08444
y.create.l HWIO_CAMSS_A_CSID_1_CSID_IRQ_CLEAR_CMD_ADDR A:0x1b08460
y.create.l HWIO_CAMSS_A_CSID_1_CSID_IRQ_MASK_ADDR A:0x1b08464
y.create.l HWIO_CAMSS_A_CSID_1_CSID_IRQ_STATUS_ADDR A:0x1b08468
y.create.l HWIO_CAMSS_A_CSID_1_CSID_CAPTURED_UNMAPPED_LONG_PKT_HDR_ADDR A:0x1b0846c
y.create.l HWIO_CAMSS_A_CSID_1_CSID_CAPTURED_MMAPPED_LONG_PKT_HDR_ADDR A:0x1b08470
y.create.l HWIO_CAMSS_A_CSID_1_CSID_CAPTURED_SHORT_PKT_ADDR A:0x1b08474
y.create.l HWIO_CAMSS_A_CSID_1_CSID_CAPTURED_LONG_PKT_HDR_ADDR A:0x1b08478
y.create.l HWIO_CAMSS_A_CSID_1_CSID_CAPTURED_LONG_PKT_FTR_ADDR A:0x1b0847c
y.create.l HWIO_CAMSS_A_CSID_1_CSID_PIF_MISR_DL0_ADDR A:0x1b08480
y.create.l HWIO_CAMSS_A_CSID_1_CSID_PIF_MISR_DL1_ADDR A:0x1b08484
y.create.l HWIO_CAMSS_A_CSID_1_CSID_PIF_MISR_DL2_ADDR A:0x1b08488
y.create.l HWIO_CAMSS_A_CSID_1_CSID_PIF_MISR_DL3_ADDR A:0x1b0848c
y.create.l HWIO_CAMSS_A_CSID_1_CSID_STATS_TOTAL_PKTS_RCVD_ADDR A:0x1b08490
y.create.l HWIO_CAMSS_A_CSID_1_CSID_STATS_ECC_ADDR A:0x1b08494
y.create.l HWIO_CAMSS_A_CSID_1_CSID_STATS_CRC_ADDR A:0x1b08498
y.create.l HWIO_CAMSS_A_CSID_1_CSID_TEST_BUS_CTRL_ADDR A:0x1b0849c
y.create.l HWIO_CAMSS_A_CSID_1_CSID_TG_CTRL_ADDR A:0x1b084a0
y.create.l HWIO_CAMSS_A_CSID_1_CSID_TG_VC_CFG_ADDR A:0x1b084a4
y.create.l HWIO_CAMSS_A_CSID_1_CSID_TG_PAYLOAD_LFSR_SEED_ADDR A:0x1b084a8
y.create.l HWIO_CAMSS_A_CSID_1_CSID_TG_DT_0_CFG_0_ADDR A:0x1b084ac
y.create.l HWIO_CAMSS_A_CSID_1_CSID_TG_DT_1_CFG_0_ADDR A:0x1b084b8
y.create.l HWIO_CAMSS_A_CSID_1_CSID_TG_DT_2_CFG_0_ADDR A:0x1b084c4
y.create.l HWIO_CAMSS_A_CSID_1_CSID_TG_DT_3_CFG_0_ADDR A:0x1b084d0
y.create.l HWIO_CAMSS_A_CSID_1_CSID_TG_DT_0_CFG_1_ADDR A:0x1b084b0
y.create.l HWIO_CAMSS_A_CSID_1_CSID_TG_DT_1_CFG_1_ADDR A:0x1b084bc
y.create.l HWIO_CAMSS_A_CSID_1_CSID_TG_DT_2_CFG_1_ADDR A:0x1b084c8
y.create.l HWIO_CAMSS_A_CSID_1_CSID_TG_DT_3_CFG_1_ADDR A:0x1b084d4
y.create.l HWIO_CAMSS_A_CSID_1_CSID_TG_DT_0_CFG_2_ADDR A:0x1b084b4
y.create.l HWIO_CAMSS_A_CSID_1_CSID_TG_DT_1_CFG_2_ADDR A:0x1b084c0
y.create.l HWIO_CAMSS_A_CSID_1_CSID_TG_DT_2_CFG_2_ADDR A:0x1b084cc
y.create.l HWIO_CAMSS_A_CSID_1_CSID_TG_DT_3_CFG_2_ADDR A:0x1b084d8
y.create.l HWIO_CAMSS_A_CSID_1_CSID_SPARE_0_ADDR A:0x1b084dc
y.create.l HWIO_CAMSS_A_CSID_1_CSID_SPARE_1_ADDR A:0x1b084e0
y.create.l HWIO_CAMSS_A_ISPIF_RST_CMD_0_ADDR A:0x1b0a008
y.create.l HWIO_CAMSS_A_ISPIF_RST_CMD_1_ADDR A:0x1b0a00c
y.create.l HWIO_CAMSS_A_ISPIF_IRQ_GLOBAL_CLEAR_CMD_ADDR A:0x1b0a01c
y.create.l HWIO_CAMSS_A_ISPIF_TEST_BUS_CTRL_ADDR A:0x1b0a020
y.create.l HWIO_CAMSS_A_ISPIF_VFE_0_CTRL_0_ADDR A:0x1b0a200
y.create.l HWIO_CAMSS_A_ISPIF_VFE_0_IRQ_MASK_0_ADDR A:0x1b0a208
y.create.l HWIO_CAMSS_A_ISPIF_VFE_0_IRQ_MASK_1_ADDR A:0x1b0a20c
y.create.l HWIO_CAMSS_A_ISPIF_VFE_0_IRQ_MASK_2_ADDR A:0x1b0a210
y.create.l HWIO_CAMSS_A_ISPIF_VFE_0_IRQ_STATUS_0_ADDR A:0x1b0a21c
y.create.l HWIO_CAMSS_A_ISPIF_VFE_0_IRQ_STATUS_1_ADDR A:0x1b0a220
y.create.l HWIO_CAMSS_A_ISPIF_VFE_0_IRQ_STATUS_2_ADDR A:0x1b0a224
y.create.l HWIO_CAMSS_A_ISPIF_VFE_0_IRQ_CLEAR_0_ADDR A:0x1b0a230
y.create.l HWIO_CAMSS_A_ISPIF_VFE_0_IRQ_CLEAR_1_ADDR A:0x1b0a234
y.create.l HWIO_CAMSS_A_ISPIF_VFE_0_IRQ_CLEAR_2_ADDR A:0x1b0a238
y.create.l HWIO_CAMSS_A_ISPIF_VFE_0_INTF_INPUT_SEL_ADDR A:0x1b0a244
y.create.l HWIO_CAMSS_A_ISPIF_VFE_0_INTF_CMD_0_ADDR A:0x1b0a248
y.create.l HWIO_CAMSS_A_ISPIF_VFE_0_INTF_CMD_1_ADDR A:0x1b0a24c
y.create.l HWIO_CAMSS_A_ISPIF_VFE_0_PIX_INTF_0_CID_MASK_ADDR A:0x1b0a254
y.create.l HWIO_CAMSS_A_ISPIF_VFE_0_PIX_INTF_1_CID_MASK_ADDR A:0x1b0a258
y.create.l HWIO_CAMSS_A_ISPIF_VFE_0_RDI_INTF_0_CID_MASK_ADDR A:0x1b0a264
y.create.l HWIO_CAMSS_A_ISPIF_VFE_0_RDI_INTF_1_CID_MASK_ADDR A:0x1b0a268
y.create.l HWIO_CAMSS_A_ISPIF_VFE_0_RDI_INTF_2_CID_MASK_ADDR A:0x1b0a26c
y.create.l HWIO_CAMSS_A_ISPIF_VFE_0_PIX_INTF_0_CROP_ADDR A:0x1b0a278
y.create.l HWIO_CAMSS_A_ISPIF_VFE_0_PIX_INTF_1_CROP_ADDR A:0x1b0a27c
y.create.l HWIO_CAMSS_A_ISPIF_VFE_0_3D_THRESHOLD_ADDR A:0x1b0a288
y.create.l HWIO_CAMSS_A_ISPIF_VFE_0_OUTPUT_SEL_ADDR A:0x1b0a28c
y.create.l HWIO_CAMSS_A_ISPIF_VFE_0_PIX_OUTPUT_0_MISR_ADDR A:0x1b0a290
y.create.l HWIO_CAMSS_A_ISPIF_VFE_0_RDI_OUTPUT_0_MISR_0_ADDR A:0x1b0a298
y.create.l HWIO_CAMSS_A_ISPIF_VFE_0_RDI_OUTPUT_1_MISR_0_ADDR A:0x1b0a2a0
y.create.l HWIO_CAMSS_A_ISPIF_VFE_0_RDI_OUTPUT_2_MISR_0_ADDR A:0x1b0a2a8
y.create.l HWIO_CAMSS_A_ISPIF_VFE_0_RDI_OUTPUT_0_MISR_1_ADDR A:0x1b0a29c
y.create.l HWIO_CAMSS_A_ISPIF_VFE_0_RDI_OUTPUT_1_MISR_1_ADDR A:0x1b0a2a4
y.create.l HWIO_CAMSS_A_ISPIF_VFE_0_RDI_OUTPUT_2_MISR_1_ADDR A:0x1b0a2ac
y.create.l HWIO_CAMSS_A_ISPIF_VFE_0_PIX_INTF_0_STATUS_ADDR A:0x1b0a2c0
y.create.l HWIO_CAMSS_A_ISPIF_VFE_0_PIX_INTF_1_STATUS_ADDR A:0x1b0a2c4
y.create.l HWIO_CAMSS_A_ISPIF_VFE_0_RDI_INTF_0_STATUS_ADDR A:0x1b0a2d0
y.create.l HWIO_CAMSS_A_ISPIF_VFE_0_RDI_INTF_1_STATUS_ADDR A:0x1b0a2d4
y.create.l HWIO_CAMSS_A_ISPIF_VFE_0_RDI_INTF_2_STATUS_ADDR A:0x1b0a2d8
y.create.l HWIO_CAMSS_A_ISPIF_VFE_0_3D_DESKEW_SIZE_ADDR A:0x1b0a2e4
y.create.l HWIO_CAMSS_A_CSI_PHY_0_MIPI_CSIPHY_LN0_CFG1_ADDR A:0x1b0ac00
y.create.l HWIO_CAMSS_A_CSI_PHY_0_MIPI_CSIPHY_LN1_CFG1_ADDR A:0x1b0ac40
y.create.l HWIO_CAMSS_A_CSI_PHY_0_MIPI_CSIPHY_LN2_CFG1_ADDR A:0x1b0ac80
y.create.l HWIO_CAMSS_A_CSI_PHY_0_MIPI_CSIPHY_LN3_CFG1_ADDR A:0x1b0acc0
y.create.l HWIO_CAMSS_A_CSI_PHY_0_MIPI_CSIPHY_LN4_CFG1_ADDR A:0x1b0ad00
y.create.l HWIO_CAMSS_A_CSI_PHY_0_MIPI_CSIPHY_LN0_CFG2_ADDR A:0x1b0ac04
y.create.l HWIO_CAMSS_A_CSI_PHY_0_MIPI_CSIPHY_LN1_CFG2_ADDR A:0x1b0ac44
y.create.l HWIO_CAMSS_A_CSI_PHY_0_MIPI_CSIPHY_LN2_CFG2_ADDR A:0x1b0ac84
y.create.l HWIO_CAMSS_A_CSI_PHY_0_MIPI_CSIPHY_LN3_CFG2_ADDR A:0x1b0acc4
y.create.l HWIO_CAMSS_A_CSI_PHY_0_MIPI_CSIPHY_LN4_CFG2_ADDR A:0x1b0ad04
y.create.l HWIO_CAMSS_A_CSI_PHY_0_MIPI_CSIPHY_LN0_CFG3_ADDR A:0x1b0ac08
y.create.l HWIO_CAMSS_A_CSI_PHY_0_MIPI_CSIPHY_LN1_CFG3_ADDR A:0x1b0ac48
y.create.l HWIO_CAMSS_A_CSI_PHY_0_MIPI_CSIPHY_LN2_CFG3_ADDR A:0x1b0ac88
y.create.l HWIO_CAMSS_A_CSI_PHY_0_MIPI_CSIPHY_LN3_CFG3_ADDR A:0x1b0acc8
y.create.l HWIO_CAMSS_A_CSI_PHY_0_MIPI_CSIPHY_LN4_CFG3_ADDR A:0x1b0ad08
y.create.l HWIO_CAMSS_A_CSI_PHY_0_MIPI_CSIPHY_LN0_CFG4_ADDR A:0x1b0ac0c
y.create.l HWIO_CAMSS_A_CSI_PHY_0_MIPI_CSIPHY_LN1_CFG4_ADDR A:0x1b0ac4c
y.create.l HWIO_CAMSS_A_CSI_PHY_0_MIPI_CSIPHY_LN2_CFG4_ADDR A:0x1b0ac8c
y.create.l HWIO_CAMSS_A_CSI_PHY_0_MIPI_CSIPHY_LN3_CFG4_ADDR A:0x1b0accc
y.create.l HWIO_CAMSS_A_CSI_PHY_0_MIPI_CSIPHY_LN4_CFG4_ADDR A:0x1b0ad0c
y.create.l HWIO_CAMSS_A_CSI_PHY_0_MIPI_CSIPHY_LN0_CFG5_ADDR A:0x1b0ac10
y.create.l HWIO_CAMSS_A_CSI_PHY_0_MIPI_CSIPHY_LN1_CFG5_ADDR A:0x1b0ac50
y.create.l HWIO_CAMSS_A_CSI_PHY_0_MIPI_CSIPHY_LN2_CFG5_ADDR A:0x1b0ac90
y.create.l HWIO_CAMSS_A_CSI_PHY_0_MIPI_CSIPHY_LN3_CFG5_ADDR A:0x1b0acd0
y.create.l HWIO_CAMSS_A_CSI_PHY_0_MIPI_CSIPHY_LN4_CFG5_ADDR A:0x1b0ad10
y.create.l HWIO_CAMSS_A_CSI_PHY_0_MIPI_CSIPHY_LN0_TEST_FORCE_ADDR A:0x1b0ac14
y.create.l HWIO_CAMSS_A_CSI_PHY_0_MIPI_CSIPHY_LN1_TEST_FORCE_ADDR A:0x1b0ac54
y.create.l HWIO_CAMSS_A_CSI_PHY_0_MIPI_CSIPHY_LN2_TEST_FORCE_ADDR A:0x1b0ac94
y.create.l HWIO_CAMSS_A_CSI_PHY_0_MIPI_CSIPHY_LN3_TEST_FORCE_ADDR A:0x1b0acd4
y.create.l HWIO_CAMSS_A_CSI_PHY_0_MIPI_CSIPHY_LN4_TEST_FORCE_ADDR A:0x1b0ad14
y.create.l HWIO_CAMSS_A_CSI_PHY_0_MIPI_CSIPHY_LN0_TEST_DPATH_ADDR A:0x1b0ac18
y.create.l HWIO_CAMSS_A_CSI_PHY_0_MIPI_CSIPHY_LN1_TEST_DPATH_ADDR A:0x1b0ac58
y.create.l HWIO_CAMSS_A_CSI_PHY_0_MIPI_CSIPHY_LN2_TEST_DPATH_ADDR A:0x1b0ac98
y.create.l HWIO_CAMSS_A_CSI_PHY_0_MIPI_CSIPHY_LN3_TEST_DPATH_ADDR A:0x1b0acd8
y.create.l HWIO_CAMSS_A_CSI_PHY_0_MIPI_CSIPHY_LN4_TEST_DPATH_ADDR A:0x1b0ad18
y.create.l HWIO_CAMSS_A_CSI_PHY_0_MIPI_CSIPHY_LN0_TEST_IMP_ADDR A:0x1b0ac1c
y.create.l HWIO_CAMSS_A_CSI_PHY_0_MIPI_CSIPHY_LN1_TEST_IMP_ADDR A:0x1b0ac5c
y.create.l HWIO_CAMSS_A_CSI_PHY_0_MIPI_CSIPHY_LN2_TEST_IMP_ADDR A:0x1b0ac9c
y.create.l HWIO_CAMSS_A_CSI_PHY_0_MIPI_CSIPHY_LN3_TEST_IMP_ADDR A:0x1b0acdc
y.create.l HWIO_CAMSS_A_CSI_PHY_0_MIPI_CSIPHY_LN4_TEST_IMP_ADDR A:0x1b0ad1c
y.create.l HWIO_CAMSS_A_CSI_PHY_0_MIPI_CSIPHY_LN0_BIST_CTL1_ADDR A:0x1b0ac20
y.create.l HWIO_CAMSS_A_CSI_PHY_0_MIPI_CSIPHY_LN1_BIST_CTL1_ADDR A:0x1b0ac60
y.create.l HWIO_CAMSS_A_CSI_PHY_0_MIPI_CSIPHY_LN2_BIST_CTL1_ADDR A:0x1b0aca0
y.create.l HWIO_CAMSS_A_CSI_PHY_0_MIPI_CSIPHY_LN3_BIST_CTL1_ADDR A:0x1b0ace0
y.create.l HWIO_CAMSS_A_CSI_PHY_0_MIPI_CSIPHY_LN4_BIST_CTL1_ADDR A:0x1b0ad20
y.create.l HWIO_CAMSS_A_CSI_PHY_0_MIPI_CSIPHY_LN0_BIST_CTL2_ADDR A:0x1b0ac24
y.create.l HWIO_CAMSS_A_CSI_PHY_0_MIPI_CSIPHY_LN1_BIST_CTL2_ADDR A:0x1b0ac64
y.create.l HWIO_CAMSS_A_CSI_PHY_0_MIPI_CSIPHY_LN2_BIST_CTL2_ADDR A:0x1b0aca4
y.create.l HWIO_CAMSS_A_CSI_PHY_0_MIPI_CSIPHY_LN3_BIST_CTL2_ADDR A:0x1b0ace4
y.create.l HWIO_CAMSS_A_CSI_PHY_0_MIPI_CSIPHY_LN4_BIST_CTL2_ADDR A:0x1b0ad24
y.create.l HWIO_CAMSS_A_CSI_PHY_0_MIPI_CSIPHY_LN0_MISC1_ADDR A:0x1b0ac28
y.create.l HWIO_CAMSS_A_CSI_PHY_0_MIPI_CSIPHY_LN1_MISC1_ADDR A:0x1b0ac68
y.create.l HWIO_CAMSS_A_CSI_PHY_0_MIPI_CSIPHY_LN2_MISC1_ADDR A:0x1b0aca8
y.create.l HWIO_CAMSS_A_CSI_PHY_0_MIPI_CSIPHY_LN3_MISC1_ADDR A:0x1b0ace8
y.create.l HWIO_CAMSS_A_CSI_PHY_0_MIPI_CSIPHY_LN4_MISC1_ADDR A:0x1b0ad28
y.create.l HWIO_CAMSS_A_CSI_PHY_0_MIPI_CSIPHY_LN0_STATUS_ADDR A:0x1b0ac2c
y.create.l HWIO_CAMSS_A_CSI_PHY_0_MIPI_CSIPHY_LN1_STATUS_ADDR A:0x1b0ac6c
y.create.l HWIO_CAMSS_A_CSI_PHY_0_MIPI_CSIPHY_LN2_STATUS_ADDR A:0x1b0acac
y.create.l HWIO_CAMSS_A_CSI_PHY_0_MIPI_CSIPHY_LN3_STATUS_ADDR A:0x1b0acec
y.create.l HWIO_CAMSS_A_CSI_PHY_0_MIPI_CSIPHY_LN4_STATUS_ADDR A:0x1b0ad2c
y.create.l HWIO_CAMSS_A_CSI_PHY_0_MIPI_CSIPHY_LN0_BIST_MISR_STAT1_ADDR A:0x1b0ac30
y.create.l HWIO_CAMSS_A_CSI_PHY_0_MIPI_CSIPHY_LN1_BIST_MISR_STAT1_ADDR A:0x1b0ac70
y.create.l HWIO_CAMSS_A_CSI_PHY_0_MIPI_CSIPHY_LN2_BIST_MISR_STAT1_ADDR A:0x1b0acb0
y.create.l HWIO_CAMSS_A_CSI_PHY_0_MIPI_CSIPHY_LN3_BIST_MISR_STAT1_ADDR A:0x1b0acf0
y.create.l HWIO_CAMSS_A_CSI_PHY_0_MIPI_CSIPHY_LN4_BIST_MISR_STAT1_ADDR A:0x1b0ad30
y.create.l HWIO_CAMSS_A_CSI_PHY_0_MIPI_CSIPHY_LN0_BIST_MISR_STAT2_ADDR A:0x1b0ac34
y.create.l HWIO_CAMSS_A_CSI_PHY_0_MIPI_CSIPHY_LN1_BIST_MISR_STAT2_ADDR A:0x1b0ac74
y.create.l HWIO_CAMSS_A_CSI_PHY_0_MIPI_CSIPHY_LN2_BIST_MISR_STAT2_ADDR A:0x1b0acb4
y.create.l HWIO_CAMSS_A_CSI_PHY_0_MIPI_CSIPHY_LN3_BIST_MISR_STAT2_ADDR A:0x1b0acf4
y.create.l HWIO_CAMSS_A_CSI_PHY_0_MIPI_CSIPHY_LN4_BIST_MISR_STAT2_ADDR A:0x1b0ad34
y.create.l HWIO_CAMSS_A_CSI_PHY_0_MIPI_CSIPHY_LN0_MISR_STAT3_ADDR A:0x1b0ac38
y.create.l HWIO_CAMSS_A_CSI_PHY_0_MIPI_CSIPHY_LN1_MISR_STAT3_ADDR A:0x1b0ac78
y.create.l HWIO_CAMSS_A_CSI_PHY_0_MIPI_CSIPHY_LN2_MISR_STAT3_ADDR A:0x1b0acb8
y.create.l HWIO_CAMSS_A_CSI_PHY_0_MIPI_CSIPHY_LN3_MISR_STAT3_ADDR A:0x1b0acf8
y.create.l HWIO_CAMSS_A_CSI_PHY_0_MIPI_CSIPHY_LN4_MISR_STAT3_ADDR A:0x1b0ad38
y.create.l HWIO_CAMSS_A_CSI_PHY_0_MIPI_CSIPHY_LN0_MISR_STAT4_ADDR A:0x1b0ac3c
y.create.l HWIO_CAMSS_A_CSI_PHY_0_MIPI_CSIPHY_LN1_MISR_STAT4_ADDR A:0x1b0ac7c
y.create.l HWIO_CAMSS_A_CSI_PHY_0_MIPI_CSIPHY_LN2_MISR_STAT4_ADDR A:0x1b0acbc
y.create.l HWIO_CAMSS_A_CSI_PHY_0_MIPI_CSIPHY_LN3_MISR_STAT4_ADDR A:0x1b0acfc
y.create.l HWIO_CAMSS_A_CSI_PHY_0_MIPI_CSIPHY_LN4_MISR_STAT4_ADDR A:0x1b0ad3c
y.create.l HWIO_CAMSS_A_CSI_PHY_0_MIPI_CSIPHY_GLBL_RESET_ADDR A:0x1b0ad40
y.create.l HWIO_CAMSS_A_CSI_PHY_0_MIPI_CSIPHY_GLBL_PWR_CFG_ADDR A:0x1b0ad44
y.create.l HWIO_CAMSS_A_CSI_PHY_0_MIPI_CSIPHY_GLBL_TEST_FORCE_ADDR A:0x1b0ad48
y.create.l HWIO_CAMSS_A_CSI_PHY_0_MIPI_CSIPHY_GLBL_TEST_IMP_ADDR A:0x1b0ad4c
y.create.l HWIO_CAMSS_A_CSI_PHY_0_MIPI_CSIPHY_GLBL_BIST_CFG1_ADDR A:0x1b0ad50
y.create.l HWIO_CAMSS_A_CSI_PHY_0_MIPI_CSIPHY_GLBL_BIST_CFG2_ADDR A:0x1b0ad54
y.create.l HWIO_CAMSS_A_CSI_PHY_0_MIPI_CSIPHY_GLBL_BIST_CFG3_ADDR A:0x1b0ad58
y.create.l HWIO_CAMSS_A_CSI_PHY_0_MIPI_CSIPHY_GLBL_BIST_CFG4_ADDR A:0x1b0ad5c
y.create.l HWIO_CAMSS_A_CSI_PHY_0_MIPI_CSIPHY_GLBL_MISR_CFG_ADDR A:0x1b0ad60
y.create.l HWIO_CAMSS_A_CSI_PHY_0_MIPI_CSIPHY_GLBL_IRQ_CMD_ADDR A:0x1b0ad64
y.create.l HWIO_CAMSS_A_CSI_PHY_0_MIPI_CSIPHY_GLBL_STATUS1_ADDR A:0x1b0ad68
y.create.l HWIO_CAMSS_A_CSI_PHY_0_MIPI_CSIPHY_DEBUG_BUS0_ADDR A:0x1b0ad6c
y.create.l HWIO_CAMSS_A_CSI_PHY_0_MIPI_CSIPHY_DEBUG_BUS1_ADDR A:0x1b0ad70
y.create.l HWIO_CAMSS_A_CSI_PHY_0_MIPI_CSIPHY_DEBUG_BUS2_ADDR A:0x1b0ad74
y.create.l HWIO_CAMSS_A_CSI_PHY_0_MIPI_CSIPHY_DEBUG_BUS3_ADDR A:0x1b0ad78
y.create.l HWIO_CAMSS_A_CSI_PHY_0_MIPI_CSIPHY_REVISION_ID0_ADDR A:0x1b0ad7c
y.create.l HWIO_CAMSS_A_CSI_PHY_0_MIPI_CSIPHY_REVISION_ID1_ADDR A:0x1b0ad80
y.create.l HWIO_CAMSS_A_CSI_PHY_0_MIPI_CSIPHY_REVISION_ID2_ADDR A:0x1b0ad84
y.create.l HWIO_CAMSS_A_CSI_PHY_0_MIPI_CSIPHY_REVISION_ID3_ADDR A:0x1b0ad88
y.create.l HWIO_CAMSS_A_CSI_PHY_0_MIPI_CSIPHY_INTERRUPT_STATUS0_ADDR A:0x1b0ad8c
y.create.l HWIO_CAMSS_A_CSI_PHY_0_MIPI_CSIPHY_INTERRUPT_STATUS1_ADDR A:0x1b0ad90
y.create.l HWIO_CAMSS_A_CSI_PHY_0_MIPI_CSIPHY_INTERRUPT_STATUS2_ADDR A:0x1b0ad94
y.create.l HWIO_CAMSS_A_CSI_PHY_0_MIPI_CSIPHY_INTERRUPT_STATUS3_ADDR A:0x1b0ad98
y.create.l HWIO_CAMSS_A_CSI_PHY_0_MIPI_CSIPHY_INTERRUPT_STATUS4_ADDR A:0x1b0ad9c
y.create.l HWIO_CAMSS_A_CSI_PHY_0_MIPI_CSIPHY_INTERRUPT_STATUS5_ADDR A:0x1b0ada0
y.create.l HWIO_CAMSS_A_CSI_PHY_0_MIPI_CSIPHY_INTERRUPT_STATUS6_ADDR A:0x1b0ada4
y.create.l HWIO_CAMSS_A_CSI_PHY_0_MIPI_CSIPHY_INTERRUPT_STATUS7_ADDR A:0x1b0ada8
y.create.l HWIO_CAMSS_A_CSI_PHY_0_MIPI_CSIPHY_INTERRUPT_MASK0_ADDR A:0x1b0adac
y.create.l HWIO_CAMSS_A_CSI_PHY_0_MIPI_CSIPHY_INTERRUPT_MASK1_ADDR A:0x1b0adb0
y.create.l HWIO_CAMSS_A_CSI_PHY_0_MIPI_CSIPHY_INTERRUPT_MASK2_ADDR A:0x1b0adb4
y.create.l HWIO_CAMSS_A_CSI_PHY_0_MIPI_CSIPHY_INTERRUPT_MASK3_ADDR A:0x1b0adb8
y.create.l HWIO_CAMSS_A_CSI_PHY_0_MIPI_CSIPHY_INTERRUPT_MASK4_ADDR A:0x1b0adbc
y.create.l HWIO_CAMSS_A_CSI_PHY_0_MIPI_CSIPHY_INTERRUPT_MASK5_ADDR A:0x1b0adc0
y.create.l HWIO_CAMSS_A_CSI_PHY_0_MIPI_CSIPHY_INTERRUPT_MASK6_ADDR A:0x1b0adc4
y.create.l HWIO_CAMSS_A_CSI_PHY_0_MIPI_CSIPHY_INTERRUPT_MASK7_ADDR A:0x1b0adc8
y.create.l HWIO_CAMSS_A_CSI_PHY_0_MIPI_CSIPHY_INTERRUPT_CLEAR0_ADDR A:0x1b0adcc
y.create.l HWIO_CAMSS_A_CSI_PHY_0_MIPI_CSIPHY_INTERRUPT_CLEAR1_ADDR A:0x1b0add0
y.create.l HWIO_CAMSS_A_CSI_PHY_0_MIPI_CSIPHY_INTERRUPT_CLEAR2_ADDR A:0x1b0add4
y.create.l HWIO_CAMSS_A_CSI_PHY_0_MIPI_CSIPHY_INTERRUPT_CLEAR3_ADDR A:0x1b0add8
y.create.l HWIO_CAMSS_A_CSI_PHY_0_MIPI_CSIPHY_INTERRUPT_CLEAR4_ADDR A:0x1b0addc
y.create.l HWIO_CAMSS_A_CSI_PHY_0_MIPI_CSIPHY_INTERRUPT_CLEAR5_ADDR A:0x1b0ade0
y.create.l HWIO_CAMSS_A_CSI_PHY_0_MIPI_CSIPHY_INTERRUPT_CLEAR6_ADDR A:0x1b0ade4
y.create.l HWIO_CAMSS_A_CSI_PHY_0_MIPI_CSIPHY_INTERRUPT_CLEAR7_ADDR A:0x1b0ade8
y.create.l HWIO_CAMSS_A_CSI_PHY_0_MIPI_CSIPHY_GLBL_T_INIT_CFG0_ADDR A:0x1b0adec
y.create.l HWIO_CAMSS_A_CSI_PHY_0_MIPI_CSIPHY_GLBL_T_INIT_CFG1_ADDR A:0x1b0adf0
y.create.l HWIO_CAMSS_A_CSI_PHY_0_MIPI_CSIPHY_T_WAKEUP_CFG0_ADDR A:0x1b0adf4
y.create.l HWIO_CAMSS_A_CSI_PHY_0_MIPI_CSIPHY_T_WAKEUP_CFG1_ADDR A:0x1b0adf8
y.create.l HWIO_CAMSS_A_CSI_PHY_0_MIPI_CSIPHY_GLBL_PWG_CFG0_ADDR A:0x1b0adfc
y.create.l HWIO_CAMSS_A_VFE_0_A_VFE_HW_VERSION_ADDR A:0x1b10000
y.create.l HWIO_CAMSS_A_VFE_0_A_VFE_GLOBAL_RESET_CMD_ADDR A:0x1b10004
y.create.l HWIO_CAMSS_A_VFE_0_A_VFE_MODULE_RESET_ADDR A:0x1b10008
y.create.l HWIO_CAMSS_A_VFE_0_A_VFE_CGC_OVERRIDE_ADDR A:0x1b1000c
y.create.l HWIO_CAMSS_A_VFE_0_A_VFE_CGC_OVERRIDE_1_ADDR A:0x1b107b8
y.create.l HWIO_CAMSS_A_VFE_0_A_VFE_MODULE_CFG_ADDR A:0x1b10010
y.create.l HWIO_CAMSS_A_VFE_0_A_VFE_CFG_ADDR A:0x1b10014
y.create.l HWIO_CAMSS_A_VFE_0_A_VFE_3D_CFG_ADDR A:0x1b10738
y.create.l HWIO_CAMSS_A_VFE_0_A_VFE_3D_POST_SCALE_CFG_ADDR A:0x1b1073c
y.create.l HWIO_CAMSS_A_VFE_0_A_VFE_IRQ_CMD_ADDR A:0x1b10018
y.create.l HWIO_CAMSS_A_VFE_0_A_VFE_IRQ_MASK_0_ADDR A:0x1b1001c
y.create.l HWIO_CAMSS_A_VFE_0_A_VFE_IRQ_MASK_1_ADDR A:0x1b10020
y.create.l HWIO_CAMSS_A_VFE_0_A_VFE_IRQ_CLEAR_0_ADDR A:0x1b10024
y.create.l HWIO_CAMSS_A_VFE_0_A_VFE_IRQ_CLEAR_1_ADDR A:0x1b10028
y.create.l HWIO_CAMSS_A_VFE_0_A_VFE_IRQ_STATUS_0_ADDR A:0x1b1002c
y.create.l HWIO_CAMSS_A_VFE_0_A_VFE_IRQ_STATUS_1_ADDR A:0x1b10030
y.create.l HWIO_CAMSS_A_VFE_0_A_VFE_IRQ_COMPOSITE_MASK_ADDR A:0x1b10034
y.create.l HWIO_CAMSS_A_VFE_0_A_VFE_VIOLATION_STATUS_ADDR A:0x1b107b4
y.create.l HWIO_CAMSS_A_VFE_0_A_VFE_BUS_CMD_ADDR A:0x1b10038
y.create.l HWIO_CAMSS_A_VFE_0_A_VFE_BUS_CFG_ADDR A:0x1b1003c
y.create.l HWIO_CAMSS_A_VFE_0_A_VFE_BUS_IO_FORMAT_CFG_ADDR A:0x1b106f8
y.create.l HWIO_CAMSS_A_VFE_0_A_VFE_BUS_XBAR_CFG_0_ADDR A:0x1b10040
y.create.l HWIO_CAMSS_A_VFE_0_A_VFE_BUS_XBAR_CFG_1_ADDR A:0x1b10044
y.create.l HWIO_CAMSS_A_VFE_0_A_VFE_BUS_WR_SKIP_CFG_ADDR A:0x1b10048
y.create.l HWIO_CAMSS_A_VFE_0_A_VFE_BUS_IMAGE_MASTER_0_WR_CFG_ADDR A:0x1b1004c
y.create.l HWIO_CAMSS_A_VFE_0_A_VFE_BUS_IMAGE_MASTER_0_WR_PING_ADDR_ADDR A:0x1b10050
y.create.l HWIO_CAMSS_A_VFE_0_A_VFE_BUS_IMAGE_MASTER_0_WR_PONG_ADDR_ADDR A:0x1b10054
y.create.l HWIO_CAMSS_A_VFE_0_A_VFE_BUS_IMAGE_MASTER_0_WR_UB_CFG_ADDR A:0x1b10058
y.create.l HWIO_CAMSS_A_VFE_0_A_VFE_BUS_IMAGE_MASTER_0_WR_IMAGE_SIZE_ADDR A:0x1b1005c
y.create.l HWIO_CAMSS_A_VFE_0_A_VFE_BUS_IMAGE_MASTER_0_WR_BUFFER_CFG_ADDR A:0x1b10060
y.create.l HWIO_CAMSS_A_VFE_0_A_VFE_BUS_IMAGE_MASTER_1_WR_CFG_ADDR A:0x1b10064
y.create.l HWIO_CAMSS_A_VFE_0_A_VFE_BUS_IMAGE_MASTER_1_WR_PING_ADDR_ADDR A:0x1b10068
y.create.l HWIO_CAMSS_A_VFE_0_A_VFE_BUS_IMAGE_MASTER_1_WR_PONG_ADDR_ADDR A:0x1b1006c
y.create.l HWIO_CAMSS_A_VFE_0_A_VFE_BUS_IMAGE_MASTER_1_WR_UB_CFG_ADDR A:0x1b10070
y.create.l HWIO_CAMSS_A_VFE_0_A_VFE_BUS_IMAGE_MASTER_1_WR_IMAGE_SIZE_ADDR A:0x1b10074
y.create.l HWIO_CAMSS_A_VFE_0_A_VFE_BUS_IMAGE_MASTER_1_WR_BUFFER_CFG_ADDR A:0x1b10078
y.create.l HWIO_CAMSS_A_VFE_0_A_VFE_BUS_IMAGE_MASTER_2_WR_CFG_ADDR A:0x1b1007c
y.create.l HWIO_CAMSS_A_VFE_0_A_VFE_BUS_IMAGE_MASTER_2_WR_PING_ADDR_ADDR A:0x1b10080
y.create.l HWIO_CAMSS_A_VFE_0_A_VFE_BUS_IMAGE_MASTER_2_WR_PONG_ADDR_ADDR A:0x1b10084
y.create.l HWIO_CAMSS_A_VFE_0_A_VFE_BUS_IMAGE_MASTER_2_WR_UB_CFG_ADDR A:0x1b10088
y.create.l HWIO_CAMSS_A_VFE_0_A_VFE_BUS_IMAGE_MASTER_2_WR_IMAGE_SIZE_ADDR A:0x1b1008c
y.create.l HWIO_CAMSS_A_VFE_0_A_VFE_BUS_IMAGE_MASTER_2_WR_BUFFER_CFG_ADDR A:0x1b10090
y.create.l HWIO_CAMSS_A_VFE_0_A_VFE_BUS_IMAGE_MASTER_3_WR_CFG_ADDR A:0x1b10094
y.create.l HWIO_CAMSS_A_VFE_0_A_VFE_BUS_IMAGE_MASTER_3_WR_PING_ADDR_ADDR A:0x1b10098
y.create.l HWIO_CAMSS_A_VFE_0_A_VFE_BUS_IMAGE_MASTER_3_WR_PONG_ADDR_ADDR A:0x1b1009c
y.create.l HWIO_CAMSS_A_VFE_0_A_VFE_BUS_IMAGE_MASTER_3_WR_UB_CFG_ADDR A:0x1b100a0
y.create.l HWIO_CAMSS_A_VFE_0_A_VFE_BUS_IMAGE_MASTER_3_WR_IMAGE_SIZE_ADDR A:0x1b100a4
y.create.l HWIO_CAMSS_A_VFE_0_A_VFE_BUS_IMAGE_MASTER_3_WR_BUFFER_CFG_ADDR A:0x1b100a8
y.create.l HWIO_CAMSS_A_VFE_0_A_VFE_BUS_IMAGE_MASTER_4_WR_CFG_ADDR A:0x1b100ac
y.create.l HWIO_CAMSS_A_VFE_0_A_VFE_BUS_IMAGE_MASTER_4_WR_PING_ADDR_ADDR A:0x1b100b0
y.create.l HWIO_CAMSS_A_VFE_0_A_VFE_BUS_IMAGE_MASTER_4_WR_PONG_ADDR_ADDR A:0x1b100b4
y.create.l HWIO_CAMSS_A_VFE_0_A_VFE_BUS_IMAGE_MASTER_4_WR_UB_CFG_ADDR A:0x1b100b8
y.create.l HWIO_CAMSS_A_VFE_0_A_VFE_BUS_IMAGE_MASTER_4_WR_IMAGE_SIZE_ADDR A:0x1b100bc
y.create.l HWIO_CAMSS_A_VFE_0_A_VFE_BUS_IMAGE_MASTER_4_WR_BUFFER_CFG_ADDR A:0x1b100c0
y.create.l HWIO_CAMSS_A_VFE_0_A_VFE_BUS_IMAGE_MASTER_5_WR_CFG_ADDR A:0x1b100c4
y.create.l HWIO_CAMSS_A_VFE_0_A_VFE_BUS_IMAGE_MASTER_5_WR_PING_ADDR_ADDR A:0x1b100c8
y.create.l HWIO_CAMSS_A_VFE_0_A_VFE_BUS_IMAGE_MASTER_5_WR_PONG_ADDR_ADDR A:0x1b100cc
y.create.l HWIO_CAMSS_A_VFE_0_A_VFE_BUS_IMAGE_MASTER_5_WR_UB_CFG_ADDR A:0x1b100d0
y.create.l HWIO_CAMSS_A_VFE_0_A_VFE_BUS_IMAGE_MASTER_5_WR_IMAGE_SIZE_ADDR A:0x1b100d4
y.create.l HWIO_CAMSS_A_VFE_0_A_VFE_BUS_IMAGE_MASTER_5_WR_BUFFER_CFG_ADDR A:0x1b100d8
y.create.l HWIO_CAMSS_A_VFE_0_A_VFE_BUS_IMAGE_MASTER_6_WR_CFG_ADDR A:0x1b100dc
y.create.l HWIO_CAMSS_A_VFE_0_A_VFE_BUS_IMAGE_MASTER_6_WR_PING_ADDR_ADDR A:0x1b100e0
y.create.l HWIO_CAMSS_A_VFE_0_A_VFE_BUS_IMAGE_MASTER_6_WR_PONG_ADDR_ADDR A:0x1b100e4
y.create.l HWIO_CAMSS_A_VFE_0_A_VFE_BUS_IMAGE_MASTER_6_WR_UB_CFG_ADDR A:0x1b100e8
y.create.l HWIO_CAMSS_A_VFE_0_A_VFE_BUS_IMAGE_MASTER_6_WR_IMAGE_SIZE_ADDR A:0x1b100ec
y.create.l HWIO_CAMSS_A_VFE_0_A_VFE_BUS_IMAGE_MASTER_6_WR_BUFFER_CFG_ADDR A:0x1b100f0
y.create.l HWIO_CAMSS_A_VFE_0_A_VFE_BUS_STATS_AE_BG_WR_PING_ADDR_ADDR A:0x1b100f4
y.create.l HWIO_CAMSS_A_VFE_0_A_VFE_BUS_STATS_AE_BG_WR_PONG_ADDR_ADDR A:0x1b100f8
y.create.l HWIO_CAMSS_A_VFE_0_A_VFE_BUS_STATS_AE_BG_WR_UB_CFG_ADDR A:0x1b100fc
y.create.l HWIO_CAMSS_A_VFE_0_A_VFE_BUS_STATS_AF_BF_WR_PING_ADDR_ADDR A:0x1b10100
y.create.l HWIO_CAMSS_A_VFE_0_A_VFE_BUS_STATS_AF_BF_WR_PONG_ADDR_ADDR A:0x1b10104
y.create.l HWIO_CAMSS_A_VFE_0_A_VFE_BUS_STATS_AF_BF_WR_UB_CFG_ADDR A:0x1b10108
y.create.l HWIO_CAMSS_A_VFE_0_A_VFE_BUS_STATS_AWB_WR_PING_ADDR_ADDR A:0x1b1010c
y.create.l HWIO_CAMSS_A_VFE_0_A_VFE_BUS_STATS_AWB_WR_PONG_ADDR_ADDR A:0x1b10110
y.create.l HWIO_CAMSS_A_VFE_0_A_VFE_BUS_STATS_AWB_WR_UB_CFG_ADDR A:0x1b10114
y.create.l HWIO_CAMSS_A_VFE_0_A_VFE_BUS_STATS_RS_WR_PING_ADDR_ADDR A:0x1b10118
y.create.l HWIO_CAMSS_A_VFE_0_A_VFE_BUS_STATS_RS_WR_PONG_ADDR_ADDR A:0x1b1011c
y.create.l HWIO_CAMSS_A_VFE_0_A_VFE_BUS_STATS_RS_WR_UB_CFG_ADDR A:0x1b10120
y.create.l HWIO_CAMSS_A_VFE_0_A_VFE_BUS_STATS_CS_WR_PING_ADDR_ADDR A:0x1b10124
y.create.l HWIO_CAMSS_A_VFE_0_A_VFE_BUS_STATS_CS_WR_PONG_ADDR_ADDR A:0x1b10128
y.create.l HWIO_CAMSS_A_VFE_0_A_VFE_BUS_STATS_CS_WR_UB_CFG_ADDR A:0x1b1012c
y.create.l HWIO_CAMSS_A_VFE_0_A_VFE_BUS_STATS_IHIST_WR_PING_ADDR_ADDR A:0x1b10130
y.create.l HWIO_CAMSS_A_VFE_0_A_VFE_BUS_STATS_IHIST_WR_PONG_ADDR_ADDR A:0x1b10134
y.create.l HWIO_CAMSS_A_VFE_0_A_VFE_BUS_STATS_IHIST_WR_UB_CFG_ADDR A:0x1b10138
y.create.l HWIO_CAMSS_A_VFE_0_A_VFE_BUS_STATS_SKIN_BHIST_WR_PING_ADDR_ADDR A:0x1b1013c
y.create.l HWIO_CAMSS_A_VFE_0_A_VFE_BUS_STATS_SKIN_BHIST_WR_PONG_ADDR_ADDR A:0x1b10140
y.create.l HWIO_CAMSS_A_VFE_0_A_VFE_BUS_STATS_SKIN_BHIST_WR_UB_CFG_ADDR A:0x1b10144
y.create.l HWIO_CAMSS_A_VFE_0_A_VFE_BUS_STRIPE_RD_ADDR_0_ADDR A:0x1b10148
y.create.l HWIO_CAMSS_A_VFE_0_A_VFE_BUS_STRIPE_RD_ADDR_1_ADDR A:0x1b1014c
y.create.l HWIO_CAMSS_A_VFE_0_A_VFE_BUS_STRIPE_RD_ADDR_2_ADDR A:0x1b10150
y.create.l HWIO_CAMSS_A_VFE_0_A_VFE_BUS_STRIPE_RD_ADDR_3_ADDR A:0x1b10154
y.create.l HWIO_CAMSS_A_VFE_0_A_VFE_BUS_STRIPE_RD_VSIZE_ADDR A:0x1b10158
y.create.l HWIO_CAMSS_A_VFE_0_A_VFE_BUS_STRIPE_RD_HSIZE_ADDR A:0x1b1015c
y.create.l HWIO_CAMSS_A_VFE_0_A_VFE_BUS_STRIPE_RD_BUFFER_CFG_ADDR A:0x1b10160
y.create.l HWIO_CAMSS_A_VFE_0_A_VFE_BUS_STRIPE_RD_UNPACK_CFG_ADDR A:0x1b10164
y.create.l HWIO_CAMSS_A_VFE_0_A_VFE_BUS_STRIPE_RD_UNPACK_ADDR A:0x1b10168
y.create.l HWIO_CAMSS_A_VFE_0_A_VFE_BUS_STRIPE_RD_PAD_SIZE_ADDR A:0x1b1016c
y.create.l HWIO_CAMSS_A_VFE_0_A_VFE_BUS_STRIPE_RD_PAD_L_UNPACK_ADDR A:0x1b10170
y.create.l HWIO_CAMSS_A_VFE_0_A_VFE_BUS_STRIPE_RD_PAD_R_UNPACK_ADDR A:0x1b10174
y.create.l HWIO_CAMSS_A_VFE_0_A_VFE_BUS_STRIPE_RD_PAD_TB_UNPACK_ADDR A:0x1b10178
y.create.l HWIO_CAMSS_A_VFE_0_A_VFE_BUS_STRIPE_RD_CROP_WIDTH_CFG_ADDR A:0x1b1072c
y.create.l HWIO_CAMSS_A_VFE_0_A_VFE_BUS_STRIPE_RD_CROP_HEIGHT_CFG_ADDR A:0x1b10730
y.create.l HWIO_CAMSS_A_VFE_0_A_VFE_BUS_PING_PONG_IRQ_EN_ADDR A:0x1b1017c
y.create.l HWIO_CAMSS_A_VFE_0_A_VFE_BUS_PING_PONG_STATUS_ADDR A:0x1b10180
y.create.l HWIO_CAMSS_A_VFE_0_A_VFE_BUS_OPERATION_STATUS_ADDR A:0x1b10184
y.create.l HWIO_CAMSS_A_VFE_0_A_VFE_BUS_PM_CMD_ADDR A:0x1b10188
y.create.l HWIO_CAMSS_A_VFE_0_A_VFE_BUS_PM_CFG_ADDR A:0x1b1018c
y.create.l HWIO_CAMSS_A_VFE_0_A_VFE_BUS_IMAGE_MASTER_0_WR_PM_STATS_0_ADDR A:0x1b10190
y.create.l HWIO_CAMSS_A_VFE_0_A_VFE_BUS_IMAGE_MASTER_0_WR_PM_STATS_1_ADDR A:0x1b10194
y.create.l HWIO_CAMSS_A_VFE_0_A_VFE_BUS_IMAGE_MASTER_1_WR_PM_STATS_0_ADDR A:0x1b10198
y.create.l HWIO_CAMSS_A_VFE_0_A_VFE_BUS_IMAGE_MASTER_1_WR_PM_STATS_1_ADDR A:0x1b1019c
y.create.l HWIO_CAMSS_A_VFE_0_A_VFE_BUS_IMAGE_MASTER_2_WR_PM_STATS_0_ADDR A:0x1b101a0
y.create.l HWIO_CAMSS_A_VFE_0_A_VFE_BUS_IMAGE_MASTER_2_WR_PM_STATS_1_ADDR A:0x1b101a4
y.create.l HWIO_CAMSS_A_VFE_0_A_VFE_BUS_IMAGE_MASTER_3_WR_PM_STATS_0_ADDR A:0x1b101a8
y.create.l HWIO_CAMSS_A_VFE_0_A_VFE_BUS_IMAGE_MASTER_3_WR_PM_STATS_1_ADDR A:0x1b101ac
y.create.l HWIO_CAMSS_A_VFE_0_A_VFE_BUS_IMAGE_MASTER_4_WR_PM_STATS_0_ADDR A:0x1b101b0
y.create.l HWIO_CAMSS_A_VFE_0_A_VFE_BUS_IMAGE_MASTER_4_WR_PM_STATS_1_ADDR A:0x1b101b4
y.create.l HWIO_CAMSS_A_VFE_0_A_VFE_BUS_IMAGE_MASTER_5_WR_PM_STATS_0_ADDR A:0x1b101b8
y.create.l HWIO_CAMSS_A_VFE_0_A_VFE_BUS_IMAGE_MASTER_5_WR_PM_STATS_1_ADDR A:0x1b101bc
y.create.l HWIO_CAMSS_A_VFE_0_A_VFE_BUS_IMAGE_MASTER_6_WR_PM_STATS_0_ADDR A:0x1b101c0
y.create.l HWIO_CAMSS_A_VFE_0_A_VFE_BUS_IMAGE_MASTER_6_WR_PM_STATS_1_ADDR A:0x1b101c4
y.create.l HWIO_CAMSS_A_VFE_0_A_VFE_BUS_MISR_CFG_ADDR A:0x1b101c8
y.create.l HWIO_CAMSS_A_VFE_0_A_VFE_BUS_MISR_MAST_CFG_0_ADDR A:0x1b101cc
y.create.l HWIO_CAMSS_A_VFE_0_A_VFE_BUS_MISR_MAST_CFG_1_ADDR A:0x1b101d0
y.create.l HWIO_CAMSS_A_VFE_0_A_VFE_BUS_MISR_RD_VAL_ADDR A:0x1b101d4
y.create.l HWIO_CAMSS_A_VFE_0_A_VFE_AXI_CMD_ADDR A:0x1b101d8
y.create.l HWIO_CAMSS_A_VFE_0_A_VFE_AXI_CFG_ADDR A:0x1b10600
y.create.l HWIO_CAMSS_A_VFE_0_A_VFE_AXI_STATUS_ADDR A:0x1b101dc
y.create.l HWIO_CAMSS_A_VFE_0_A_VFE_BUS_BDG_QOS_CFG_0_ADDR A:0x1b107bc
y.create.l HWIO_CAMSS_A_VFE_0_A_VFE_BUS_BDG_QOS_CFG_1_ADDR A:0x1b107c0
y.create.l HWIO_CAMSS_A_VFE_0_A_VFE_BUS_BDG_QOS_CFG_2_ADDR A:0x1b107c4
y.create.l HWIO_CAMSS_A_VFE_0_A_VFE_BUS_BDG_QOS_CFG_3_ADDR A:0x1b107c8
y.create.l HWIO_CAMSS_A_VFE_0_A_VFE_BUS_BDG_QOS_CFG_4_ADDR A:0x1b107cc
y.create.l HWIO_CAMSS_A_VFE_0_A_VFE_BUS_BDG_QOS_CFG_5_ADDR A:0x1b107d0
y.create.l HWIO_CAMSS_A_VFE_0_A_VFE_BUS_BDG_QOS_CFG_6_ADDR A:0x1b107d4
y.create.l HWIO_CAMSS_A_VFE_0_A_VFE_BUS_BDG_QOS_CFG_7_ADDR A:0x1b10798
y.create.l HWIO_CAMSS_A_VFE_0_A_VFE_BUS_BDG_DS_CFG_0_ADDR A:0x1b107d8
y.create.l HWIO_CAMSS_A_VFE_0_A_VFE_BUS_BDG_DS_CFG_1_ADDR A:0x1b107dc
y.create.l HWIO_CAMSS_A_VFE_0_A_VFE_BUS_BDG_DS_CFG_2_ADDR A:0x1b107e0
y.create.l HWIO_CAMSS_A_VFE_0_A_VFE_BUS_BDG_DS_CFG_3_ADDR A:0x1b107e4
y.create.l HWIO_CAMSS_A_VFE_0_A_VFE_BUS_BDG_DS_CFG_4_ADDR A:0x1b107e8
y.create.l HWIO_CAMSS_A_VFE_0_A_VFE_BUS_BDG_DS_CFG_5_ADDR A:0x1b107ec
y.create.l HWIO_CAMSS_A_VFE_0_A_VFE_BUS_BDG_DS_CFG_6_ADDR A:0x1b107f0
y.create.l HWIO_CAMSS_A_VFE_0_A_VFE_BUS_BDG_DS_CFG_7_ADDR A:0x1b107f4
y.create.l HWIO_CAMSS_A_VFE_0_A_VFE_BUS_BDG_DS_CFG_8_ADDR A:0x1b107f8
y.create.l HWIO_CAMSS_A_VFE_0_A_VFE_BUS_BDG_DS_CFG_9_ADDR A:0x1b107fc
y.create.l HWIO_CAMSS_A_VFE_0_A_VFE_BUS_BDG_DS_CFG_10_ADDR A:0x1b10800
y.create.l HWIO_CAMSS_A_VFE_0_A_VFE_BUS_BDG_DS_CFG_11_ADDR A:0x1b10804
y.create.l HWIO_CAMSS_A_VFE_0_A_VFE_BUS_BDG_DS_CFG_12_ADDR A:0x1b10808
y.create.l HWIO_CAMSS_A_VFE_0_A_VFE_BUS_BDG_DS_CFG_13_ADDR A:0x1b1080c
y.create.l HWIO_CAMSS_A_VFE_0_A_VFE_BUS_BDG_DS_CFG_16_ADDR A:0x1b10810
y.create.l HWIO_CAMSS_A_VFE_0_A_VFE_PIXEL_IF_CFG_ADDR A:0x1b106fc
y.create.l HWIO_CAMSS_A_VFE_0_A_VFE_RDI_CFG_0_ADDR A:0x1b10734
y.create.l HWIO_CAMSS_A_VFE_0_A_VFE_RDI_CFG_1_ADDR A:0x1b107a4
y.create.l HWIO_CAMSS_A_VFE_0_A_CAMIF_CMD_ADDR A:0x1b101e0
y.create.l HWIO_CAMSS_A_VFE_0_A_CAMIF_CFG_ADDR A:0x1b101e4
y.create.l HWIO_CAMSS_A_VFE_0_A_CAMIF_EFS_CFG_ADDR A:0x1b101e8
y.create.l HWIO_CAMSS_A_VFE_0_A_CAMIF_FRAME_CFG_ADDR A:0x1b101ec
y.create.l HWIO_CAMSS_A_VFE_0_A_CAMIF_WINDOW_WIDTH_CFG_ADDR A:0x1b101f0
y.create.l HWIO_CAMSS_A_VFE_0_A_CAMIF_WINDOW_HEIGHT_CFG_ADDR A:0x1b101f4
y.create.l HWIO_CAMSS_A_VFE_0_A_CAMIF_SUBSAMPLE_CFG_1_ADDR A:0x1b101f8
y.create.l HWIO_CAMSS_A_VFE_0_A_CAMIF_SUBSAMPLE_CFG_2_ADDR A:0x1b101fc
y.create.l HWIO_CAMSS_A_VFE_0_A_CAMIF_EPOCH_IRQ_ADDR A:0x1b10200
y.create.l HWIO_CAMSS_A_VFE_0_A_CAMIF_STATUS_ADDR A:0x1b10204
y.create.l HWIO_CAMSS_A_VFE_0_A_CAMIF_MISR_ADDR A:0x1b10208
y.create.l HWIO_CAMSS_A_VFE_0_A_VFE_SYNC_TIMER_CMD_ADDR A:0x1b1020c
y.create.l HWIO_CAMSS_A_VFE_0_A_VFE_SYNC_TIMER0_LINE_START_ADDR A:0x1b10210
y.create.l HWIO_CAMSS_A_VFE_0_A_VFE_SYNC_TIMER0_PIXEL_START_ADDR A:0x1b10214
y.create.l HWIO_CAMSS_A_VFE_0_A_VFE_SYNC_TIMER0_PIXEL_DURATION_ADDR A:0x1b10218
y.create.l HWIO_CAMSS_A_VFE_0_A_VFE_SYNC_TIMER1_LINE_START_ADDR A:0x1b1021c
y.create.l HWIO_CAMSS_A_VFE_0_A_VFE_SYNC_TIMER1_PIXEL_START_ADDR A:0x1b10220
y.create.l HWIO_CAMSS_A_VFE_0_A_VFE_SYNC_TIMER1_PIXEL_DURATION_ADDR A:0x1b10224
y.create.l HWIO_CAMSS_A_VFE_0_A_VFE_SYNC_TIMER2_LINE_START_ADDR A:0x1b10228
y.create.l HWIO_CAMSS_A_VFE_0_A_VFE_SYNC_TIMER2_PIXEL_START_ADDR A:0x1b1022c
y.create.l HWIO_CAMSS_A_VFE_0_A_VFE_SYNC_TIMER2_PIXEL_DURATION_ADDR A:0x1b10230
y.create.l HWIO_CAMSS_A_VFE_0_A_VFE_SYNC_TIMER_POLARITY_ADDR A:0x1b10234
y.create.l HWIO_CAMSS_A_VFE_0_A_VFE_ASYNC_TIMER_CMD_ADDR A:0x1b10238
y.create.l HWIO_CAMSS_A_VFE_0_A_VFE_ASYNC_TIMER0_CFG_0_ADDR A:0x1b1023c
y.create.l HWIO_CAMSS_A_VFE_0_A_VFE_ASYNC_TIMER0_CFG_1_ADDR A:0x1b10240
y.create.l HWIO_CAMSS_A_VFE_0_A_VFE_ASYNC_TIMER1_CFG_0_ADDR A:0x1b10244
y.create.l HWIO_CAMSS_A_VFE_0_A_VFE_ASYNC_TIMER1_CFG_1_ADDR A:0x1b10248
y.create.l HWIO_CAMSS_A_VFE_0_A_VFE_ASYNC_TIMER2_CFG_0_ADDR A:0x1b1024c
y.create.l HWIO_CAMSS_A_VFE_0_A_VFE_ASYNC_TIMER2_CFG_1_ADDR A:0x1b10250
y.create.l HWIO_CAMSS_A_VFE_0_A_VFE_ASYNC_TIMER3_CFG_0_ADDR A:0x1b10254
y.create.l HWIO_CAMSS_A_VFE_0_A_VFE_ASYNC_TIMER3_CFG_1_ADDR A:0x1b10258
y.create.l HWIO_CAMSS_A_VFE_0_A_VFE_TIMER_SEL_ADDR A:0x1b1025c
y.create.l HWIO_CAMSS_A_VFE_0_A_VFE_REG_UPDATE_CMD_ADDR A:0x1b10260
y.create.l HWIO_CAMSS_A_VFE_0_A_VFE_BLACK_CFG_ADDR A:0x1b10264
y.create.l HWIO_CAMSS_A_VFE_0_A_VFE_BLACK_INTERP_R_0_ADDR A:0x1b10268
y.create.l HWIO_CAMSS_A_VFE_0_A_VFE_BLACK_INTERP_R_1_ADDR A:0x1b1026c
y.create.l HWIO_CAMSS_A_VFE_0_A_VFE_BLACK_INTERP_R_2_ADDR A:0x1b10270
y.create.l HWIO_CAMSS_A_VFE_0_A_VFE_BLACK_INTERP_R_3_ADDR A:0x1b1067c
y.create.l HWIO_CAMSS_A_VFE_0_A_VFE_BLACK_INTERP_GB_0_ADDR A:0x1b10680
y.create.l HWIO_CAMSS_A_VFE_0_A_VFE_BLACK_INTERP_GB_1_ADDR A:0x1b10684
y.create.l HWIO_CAMSS_A_VFE_0_A_VFE_BLACK_INTERP_GB_2_ADDR A:0x1b10688
y.create.l HWIO_CAMSS_A_VFE_0_A_VFE_BLACK_INTERP_GB_3_ADDR A:0x1b1068c
y.create.l HWIO_CAMSS_A_VFE_0_A_VFE_BLACK_INTERP_B_0_ADDR A:0x1b10690
y.create.l HWIO_CAMSS_A_VFE_0_A_VFE_BLACK_INTERP_B_1_ADDR A:0x1b10694
y.create.l HWIO_CAMSS_A_VFE_0_A_VFE_BLACK_INTERP_B_2_ADDR A:0x1b10698
y.create.l HWIO_CAMSS_A_VFE_0_A_VFE_BLACK_INTERP_B_3_ADDR A:0x1b1069c
y.create.l HWIO_CAMSS_A_VFE_0_A_VFE_BLACK_INTERP_GR_0_ADDR A:0x1b106a0
y.create.l HWIO_CAMSS_A_VFE_0_A_VFE_BLACK_INTERP_GR_1_ADDR A:0x1b106a4
y.create.l HWIO_CAMSS_A_VFE_0_A_VFE_BLACK_INTERP_GR_2_ADDR A:0x1b106a8
y.create.l HWIO_CAMSS_A_VFE_0_A_VFE_BLACK_INTERP_GR_3_ADDR A:0x1b106ac
y.create.l HWIO_CAMSS_A_VFE_0_A_VFE_BLACK_RIGHT_INTERP_R_0_ADDR A:0x1b10740
y.create.l HWIO_CAMSS_A_VFE_0_A_VFE_BLACK_RIGHT_INTERP_R_1_ADDR A:0x1b10744
y.create.l HWIO_CAMSS_A_VFE_0_A_VFE_BLACK_RIGHT_INTERP_R_2_ADDR A:0x1b10748
y.create.l HWIO_CAMSS_A_VFE_0_A_VFE_BLACK_RIGHT_INTERP_R_3_ADDR A:0x1b1074c
y.create.l HWIO_CAMSS_A_VFE_0_A_VFE_BLACK_RIGHT_INTERP_GB_0_ADDR A:0x1b10750
y.create.l HWIO_CAMSS_A_VFE_0_A_VFE_BLACK_RIGHT_INTERP_GB_1_ADDR A:0x1b10754
y.create.l HWIO_CAMSS_A_VFE_0_A_VFE_BLACK_RIGHT_INTERP_GB_2_ADDR A:0x1b10758
y.create.l HWIO_CAMSS_A_VFE_0_A_VFE_BLACK_RIGHT_INTERP_GB_3_ADDR A:0x1b1075c
y.create.l HWIO_CAMSS_A_VFE_0_A_VFE_BLACK_RIGHT_INTERP_B_0_ADDR A:0x1b10760
y.create.l HWIO_CAMSS_A_VFE_0_A_VFE_BLACK_RIGHT_INTERP_B_1_ADDR A:0x1b10764
y.create.l HWIO_CAMSS_A_VFE_0_A_VFE_BLACK_RIGHT_INTERP_B_2_ADDR A:0x1b10768
y.create.l HWIO_CAMSS_A_VFE_0_A_VFE_BLACK_RIGHT_INTERP_B_3_ADDR A:0x1b1076c
y.create.l HWIO_CAMSS_A_VFE_0_A_VFE_BLACK_RIGHT_INTERP_GR_0_ADDR A:0x1b10770
y.create.l HWIO_CAMSS_A_VFE_0_A_VFE_BLACK_RIGHT_INTERP_GR_1_ADDR A:0x1b10774
y.create.l HWIO_CAMSS_A_VFE_0_A_VFE_BLACK_RIGHT_INTERP_GR_2_ADDR A:0x1b10780
y.create.l HWIO_CAMSS_A_VFE_0_A_VFE_BLACK_RIGHT_INTERP_GR_3_ADDR A:0x1b1078c
y.create.l HWIO_CAMSS_A_VFE_0_A_VFE_ROLLOFF_CFG_ADDR A:0x1b10274
y.create.l HWIO_CAMSS_A_VFE_0_A_VFE_ROLLOFF_GRID_CFG_0_ADDR A:0x1b10278
y.create.l HWIO_CAMSS_A_VFE_0_A_VFE_ROLLOFF_GRID_CFG_1_ADDR A:0x1b1027c
y.create.l HWIO_CAMSS_A_VFE_0_A_VFE_ROLLOFF_RIGHT_GRID_CFG_0_ADDR A:0x1b10280
y.create.l HWIO_CAMSS_A_VFE_0_A_VFE_ROLLOFF_RIGHT_GRID_CFG_1_ADDR A:0x1b107a8
y.create.l HWIO_CAMSS_A_VFE_0_A_VFE_ROLLOFF_STRIPE_CFG_0_ADDR A:0x1b107ac
y.create.l HWIO_CAMSS_A_VFE_0_A_VFE_ROLLOFF_STRIPE_CFG_1_ADDR A:0x1b107b0
y.create.l HWIO_CAMSS_A_VFE_0_A_VFE_DEMUX_CFG_ADDR A:0x1b10284
y.create.l HWIO_CAMSS_A_VFE_0_A_VFE_DEMUX_GAIN_0_ADDR A:0x1b10288
y.create.l HWIO_CAMSS_A_VFE_0_A_VFE_DEMUX_GAIN_1_ADDR A:0x1b1028c
y.create.l HWIO_CAMSS_A_VFE_0_A_VFE_DEMUX_RIGHT_GAIN_0_ADDR A:0x1b10790
y.create.l HWIO_CAMSS_A_VFE_0_A_VFE_DEMUX_RIGHT_GAIN_1_ADDR A:0x1b1079c
y.create.l HWIO_CAMSS_A_VFE_0_A_VFE_DEMUX_EVEN_CFG_ADDR A:0x1b10290
y.create.l HWIO_CAMSS_A_VFE_0_A_VFE_DEMUX_ODD_CFG_ADDR A:0x1b10294
y.create.l HWIO_CAMSS_A_VFE_0_A_VFE_DEMOSAIC_CFG_ADDR A:0x1b10298
y.create.l HWIO_CAMSS_A_VFE_0_A_VFE_DEMOSAIC_DBPC_CFG_ADDR A:0x1b1029c
y.create.l HWIO_CAMSS_A_VFE_0_A_VFE_DEMOSAIC_DBPC_OFFSET_CFG_0_ADDR A:0x1b102a0
y.create.l HWIO_CAMSS_A_VFE_0_A_VFE_DEMOSAIC_DBPC_OFFSET_CFG_1_ADDR A:0x1b10604
y.create.l HWIO_CAMSS_A_VFE_0_A_VFE_DEMOSAIC_DBPC_OFFSET_CFG_2_ADDR A:0x1b10608
y.create.l HWIO_CAMSS_A_VFE_0_A_VFE_DEMOSAIC_DBCC_CFG_ADDR A:0x1b1060c
y.create.l HWIO_CAMSS_A_VFE_0_A_VFE_DEMOSAIC_DBCC_OFFSET_CFG_0_ADDR A:0x1b10610
y.create.l HWIO_CAMSS_A_VFE_0_A_VFE_DEMOSAIC_DBCC_OFFSET_CFG_1_ADDR A:0x1b10614
y.create.l HWIO_CAMSS_A_VFE_0_A_VFE_DEMOSAIC_DBCC_OFFSET_CFG_2_ADDR A:0x1b10618
y.create.l HWIO_CAMSS_A_VFE_0_A_VFE_DEMOSAIC_ABF_GREEN_CFG_0_ADDR A:0x1b102a4
y.create.l HWIO_CAMSS_A_VFE_0_A_VFE_DEMOSAIC_ABF_GREEN_CFG_1_ADDR A:0x1b102a8
y.create.l HWIO_CAMSS_A_VFE_0_A_VFE_DEMOSAIC_ABF_GREEN_CFG_2_ADDR A:0x1b102ac
y.create.l HWIO_CAMSS_A_VFE_0_A_VFE_DEMOSAIC_ABF_GREEN_POS_LUT_0_ADDR A:0x1b102b0
y.create.l HWIO_CAMSS_A_VFE_0_A_VFE_DEMOSAIC_ABF_GREEN_POS_LUT_1_ADDR A:0x1b102b4
y.create.l HWIO_CAMSS_A_VFE_0_A_VFE_DEMOSAIC_ABF_GREEN_POS_LUT_2_ADDR A:0x1b102b8
y.create.l HWIO_CAMSS_A_VFE_0_A_VFE_DEMOSAIC_ABF_GREEN_POS_LUT_3_ADDR A:0x1b102bc
y.create.l HWIO_CAMSS_A_VFE_0_A_VFE_DEMOSAIC_ABF_GREEN_POS_LUT_4_ADDR A:0x1b102c0
y.create.l HWIO_CAMSS_A_VFE_0_A_VFE_DEMOSAIC_ABF_GREEN_POS_LUT_5_ADDR A:0x1b102c4
y.create.l HWIO_CAMSS_A_VFE_0_A_VFE_DEMOSAIC_ABF_GREEN_POS_LUT_6_ADDR A:0x1b102c8
y.create.l HWIO_CAMSS_A_VFE_0_A_VFE_DEMOSAIC_ABF_GREEN_POS_LUT_7_ADDR A:0x1b102cc
y.create.l HWIO_CAMSS_A_VFE_0_A_VFE_DEMOSAIC_ABF_GREEN_NEG_LUT_0_ADDR A:0x1b102d0
y.create.l HWIO_CAMSS_A_VFE_0_A_VFE_DEMOSAIC_ABF_GREEN_NEG_LUT_1_ADDR A:0x1b102d4
y.create.l HWIO_CAMSS_A_VFE_0_A_VFE_DEMOSAIC_ABF_GREEN_NEG_LUT_2_ADDR A:0x1b102d8
y.create.l HWIO_CAMSS_A_VFE_0_A_VFE_DEMOSAIC_ABF_GREEN_NEG_LUT_3_ADDR A:0x1b102dc
y.create.l HWIO_CAMSS_A_VFE_0_A_VFE_DEMOSAIC_ABF_BLUE_CFG_0_ADDR A:0x1b102e0
y.create.l HWIO_CAMSS_A_VFE_0_A_VFE_DEMOSAIC_ABF_BLUE_CFG_1_ADDR A:0x1b102e4
y.create.l HWIO_CAMSS_A_VFE_0_A_VFE_DEMOSAIC_ABF_BLUE_CFG_2_ADDR A:0x1b102e8
y.create.l HWIO_CAMSS_A_VFE_0_A_VFE_DEMOSAIC_ABF_BLUE_POS_LUT_0_ADDR A:0x1b102ec
y.create.l HWIO_CAMSS_A_VFE_0_A_VFE_DEMOSAIC_ABF_BLUE_POS_LUT_1_ADDR A:0x1b102f0
y.create.l HWIO_CAMSS_A_VFE_0_A_VFE_DEMOSAIC_ABF_BLUE_POS_LUT_2_ADDR A:0x1b102f4
y.create.l HWIO_CAMSS_A_VFE_0_A_VFE_DEMOSAIC_ABF_BLUE_POS_LUT_3_ADDR A:0x1b102f8
y.create.l HWIO_CAMSS_A_VFE_0_A_VFE_DEMOSAIC_ABF_BLUE_POS_LUT_4_ADDR A:0x1b102fc
y.create.l HWIO_CAMSS_A_VFE_0_A_VFE_DEMOSAIC_ABF_BLUE_POS_LUT_5_ADDR A:0x1b10300
y.create.l HWIO_CAMSS_A_VFE_0_A_VFE_DEMOSAIC_ABF_BLUE_POS_LUT_6_ADDR A:0x1b10304
y.create.l HWIO_CAMSS_A_VFE_0_A_VFE_DEMOSAIC_ABF_BLUE_POS_LUT_7_ADDR A:0x1b10308
y.create.l HWIO_CAMSS_A_VFE_0_A_VFE_DEMOSAIC_ABF_BLUE_NEG_LUT_0_ADDR A:0x1b1030c
y.create.l HWIO_CAMSS_A_VFE_0_A_VFE_DEMOSAIC_ABF_BLUE_NEG_LUT_1_ADDR A:0x1b10310
y.create.l HWIO_CAMSS_A_VFE_0_A_VFE_DEMOSAIC_ABF_BLUE_NEG_LUT_2_ADDR A:0x1b10314
y.create.l HWIO_CAMSS_A_VFE_0_A_VFE_DEMOSAIC_ABF_BLUE_NEG_LUT_3_ADDR A:0x1b10318
y.create.l HWIO_CAMSS_A_VFE_0_A_VFE_DEMOSAIC_ABF_RED_CFG_0_ADDR A:0x1b1031c
y.create.l HWIO_CAMSS_A_VFE_0_A_VFE_DEMOSAIC_ABF_RED_CFG_1_ADDR A:0x1b10320
y.create.l HWIO_CAMSS_A_VFE_0_A_VFE_DEMOSAIC_ABF_RED_CFG_2_ADDR A:0x1b10324
y.create.l HWIO_CAMSS_A_VFE_0_A_VFE_DEMOSAIC_ABF_RED_POS_LUT_0_ADDR A:0x1b10328
y.create.l HWIO_CAMSS_A_VFE_0_A_VFE_DEMOSAIC_ABF_RED_POS_LUT_1_ADDR A:0x1b1032c
y.create.l HWIO_CAMSS_A_VFE_0_A_VFE_DEMOSAIC_ABF_RED_POS_LUT_2_ADDR A:0x1b10330
y.create.l HWIO_CAMSS_A_VFE_0_A_VFE_DEMOSAIC_ABF_RED_POS_LUT_3_ADDR A:0x1b10334
y.create.l HWIO_CAMSS_A_VFE_0_A_VFE_DEMOSAIC_ABF_RED_POS_LUT_4_ADDR A:0x1b10338
y.create.l HWIO_CAMSS_A_VFE_0_A_VFE_DEMOSAIC_ABF_RED_POS_LUT_5_ADDR A:0x1b1033c
y.create.l HWIO_CAMSS_A_VFE_0_A_VFE_DEMOSAIC_ABF_RED_POS_LUT_6_ADDR A:0x1b10340
y.create.l HWIO_CAMSS_A_VFE_0_A_VFE_DEMOSAIC_ABF_RED_POS_LUT_7_ADDR A:0x1b10344
y.create.l HWIO_CAMSS_A_VFE_0_A_VFE_DEMOSAIC_ABF_RED_NEG_LUT_0_ADDR A:0x1b10348
y.create.l HWIO_CAMSS_A_VFE_0_A_VFE_DEMOSAIC_ABF_RED_NEG_LUT_1_ADDR A:0x1b1034c
y.create.l HWIO_CAMSS_A_VFE_0_A_VFE_DEMOSAIC_ABF_RED_NEG_LUT_2_ADDR A:0x1b10350
y.create.l HWIO_CAMSS_A_VFE_0_A_VFE_DEMOSAIC_ABF_RED_NEG_LUT_3_ADDR A:0x1b10354
y.create.l HWIO_CAMSS_A_VFE_0_A_VFE_DEMOSAIC_INTERP_WB_GAIN_0_ADDR A:0x1b1061c
y.create.l HWIO_CAMSS_A_VFE_0_A_VFE_DEMOSAIC_INTERP_WB_GAIN_1_ADDR A:0x1b10620
y.create.l HWIO_CAMSS_A_VFE_0_A_VFE_DEMOSAIC_INTERP_CLASSIFIER_0_ADDR A:0x1b10624
y.create.l HWIO_CAMSS_A_VFE_0_A_VFE_DEMOSAIC_INTERP_CLASSIFIER_1_ADDR A:0x1b10628
y.create.l HWIO_CAMSS_A_VFE_0_A_VFE_DEMOSAIC_INTERP_CLASSIFIER_2_ADDR A:0x1b1062c
y.create.l HWIO_CAMSS_A_VFE_0_A_VFE_DEMOSAIC_INTERP_CLASSIFIER_3_ADDR A:0x1b10630
y.create.l HWIO_CAMSS_A_VFE_0_A_VFE_DEMOSAIC_INTERP_CLASSIFIER_4_ADDR A:0x1b10634
y.create.l HWIO_CAMSS_A_VFE_0_A_VFE_DEMOSAIC_INTERP_CLASSIFIER_5_ADDR A:0x1b10638
y.create.l HWIO_CAMSS_A_VFE_0_A_VFE_DEMOSAIC_INTERP_CLASSIFIER_6_ADDR A:0x1b1063c
y.create.l HWIO_CAMSS_A_VFE_0_A_VFE_DEMOSAIC_INTERP_CLASSIFIER_7_ADDR A:0x1b10640
y.create.l HWIO_CAMSS_A_VFE_0_A_VFE_DEMOSAIC_INTERP_CLASSIFIER_8_ADDR A:0x1b10644
y.create.l HWIO_CAMSS_A_VFE_0_A_VFE_DEMOSAIC_INTERP_CLASSIFIER_9_ADDR A:0x1b10648
y.create.l HWIO_CAMSS_A_VFE_0_A_VFE_DEMOSAIC_INTERP_G_0_ADDR A:0x1b1066c
y.create.l HWIO_CAMSS_A_VFE_0_A_VFE_DEMOSAIC_INTERP_G_1_ADDR A:0x1b10670
y.create.l HWIO_CAMSS_A_VFE_0_A_VFE_DEMOSAIC_DBPC_STATS_ADDR A:0x1b10358
y.create.l HWIO_CAMSS_A_VFE_0_A_VFE_DEMOSAIC_DBCC_STATS_0_ADDR A:0x1b10674
y.create.l HWIO_CAMSS_A_VFE_0_A_VFE_DEMOSAIC_DBCC_STATS_1_ADDR A:0x1b10678
y.create.l HWIO_CAMSS_A_VFE_0_A_VFE_CHROMA_UPSAMPLE_CFG_ADDR A:0x1b1035c
y.create.l HWIO_CAMSS_A_VFE_0_A_VFE_CROP_WIDTH_CFG_ADDR A:0x1b10360
y.create.l HWIO_CAMSS_A_VFE_0_A_VFE_CROP_HEIGHT_CFG_ADDR A:0x1b10364
y.create.l HWIO_CAMSS_A_VFE_0_A_VFE_SCALE_CFG_ADDR A:0x1b10368
y.create.l HWIO_CAMSS_A_VFE_0_A_VFE_SCALE_H_IMAGE_SIZE_CFG_ADDR A:0x1b1036c
y.create.l HWIO_CAMSS_A_VFE_0_A_VFE_SCALE_H_PHASE_CFG_ADDR A:0x1b10370
y.create.l HWIO_CAMSS_A_VFE_0_A_VFE_SCALE_H_STRIPE_CFG_ADDR A:0x1b10374
y.create.l HWIO_CAMSS_A_VFE_0_A_VFE_SCALE_V_IMAGE_SIZE_CFG_ADDR A:0x1b10378
y.create.l HWIO_CAMSS_A_VFE_0_A_VFE_SCALE_V_PHASE_CFG_ADDR A:0x1b1037c
y.create.l HWIO_CAMSS_A_VFE_0_A_VFE_SCALE_V_STRIPE_CFG_ADDR A:0x1b10380
y.create.l HWIO_CAMSS_A_VFE_0_A_VFE_WB_CFG_ADDR A:0x1b10384
y.create.l HWIO_CAMSS_A_VFE_0_A_VFE_WB_RIGHT_CFG_ADDR A:0x1b107a0
y.create.l HWIO_CAMSS_A_VFE_0_A_VFE_CLF_CFG_ADDR A:0x1b106b0
y.create.l HWIO_CAMSS_A_VFE_0_A_VFE_CLF_LUMA_CFG_0_ADDR A:0x1b106b4
y.create.l HWIO_CAMSS_A_VFE_0_A_VFE_CLF_LUMA_CFG_1_ADDR A:0x1b106b8
y.create.l HWIO_CAMSS_A_VFE_0_A_VFE_CLF_LUMA_CFG_2_ADDR A:0x1b106bc
y.create.l HWIO_CAMSS_A_VFE_0_A_VFE_CLF_LUMA_POS_LUT_0_ADDR A:0x1b106c0
y.create.l HWIO_CAMSS_A_VFE_0_A_VFE_CLF_LUMA_POS_LUT_1_ADDR A:0x1b106c4
y.create.l HWIO_CAMSS_A_VFE_0_A_VFE_CLF_LUMA_POS_LUT_2_ADDR A:0x1b106c8
y.create.l HWIO_CAMSS_A_VFE_0_A_VFE_CLF_LUMA_POS_LUT_3_ADDR A:0x1b106cc
y.create.l HWIO_CAMSS_A_VFE_0_A_VFE_CLF_LUMA_POS_LUT_4_ADDR A:0x1b106d0
y.create.l HWIO_CAMSS_A_VFE_0_A_VFE_CLF_LUMA_POS_LUT_5_ADDR A:0x1b106d4
y.create.l HWIO_CAMSS_A_VFE_0_A_VFE_CLF_LUMA_POS_LUT_6_ADDR A:0x1b106d8
y.create.l HWIO_CAMSS_A_VFE_0_A_VFE_CLF_LUMA_POS_LUT_7_ADDR A:0x1b106dc
y.create.l HWIO_CAMSS_A_VFE_0_A_VFE_CLF_LUMA_NEG_LUT_0_ADDR A:0x1b106e0
y.create.l HWIO_CAMSS_A_VFE_0_A_VFE_CLF_LUMA_NEG_LUT_1_ADDR A:0x1b106e4
y.create.l HWIO_CAMSS_A_VFE_0_A_VFE_CLF_LUMA_NEG_LUT_2_ADDR A:0x1b106e8
y.create.l HWIO_CAMSS_A_VFE_0_A_VFE_CLF_LUMA_NEG_LUT_3_ADDR A:0x1b106ec
y.create.l HWIO_CAMSS_A_VFE_0_A_VFE_CLF_CHROMA_COEFF_0_ADDR A:0x1b106f0
y.create.l HWIO_CAMSS_A_VFE_0_A_VFE_CLF_CHROMA_COEFF_1_ADDR A:0x1b106f4
y.create.l HWIO_CAMSS_A_VFE_0_A_VFE_COLOR_CORRECT_COEFF_0_ADDR A:0x1b10388
y.create.l HWIO_CAMSS_A_VFE_0_A_VFE_COLOR_CORRECT_COEFF_1_ADDR A:0x1b1038c
y.create.l HWIO_CAMSS_A_VFE_0_A_VFE_COLOR_CORRECT_COEFF_2_ADDR A:0x1b10390
y.create.l HWIO_CAMSS_A_VFE_0_A_VFE_COLOR_CORRECT_COEFF_3_ADDR A:0x1b10394
y.create.l HWIO_CAMSS_A_VFE_0_A_VFE_COLOR_CORRECT_COEFF_4_ADDR A:0x1b10398
y.create.l HWIO_CAMSS_A_VFE_0_A_VFE_COLOR_CORRECT_COEFF_5_ADDR A:0x1b1039c
y.create.l HWIO_CAMSS_A_VFE_0_A_VFE_COLOR_CORRECT_COEFF_6_ADDR A:0x1b103a0
y.create.l HWIO_CAMSS_A_VFE_0_A_VFE_COLOR_CORRECT_COEFF_7_ADDR A:0x1b103a4
y.create.l HWIO_CAMSS_A_VFE_0_A_VFE_COLOR_CORRECT_COEFF_8_ADDR A:0x1b103a8
y.create.l HWIO_CAMSS_A_VFE_0_A_VFE_COLOR_CORRECT_OFFSET_0_ADDR A:0x1b103ac
y.create.l HWIO_CAMSS_A_VFE_0_A_VFE_COLOR_CORRECT_OFFSET_1_ADDR A:0x1b103b0
y.create.l HWIO_CAMSS_A_VFE_0_A_VFE_COLOR_CORRECT_OFFSET_2_ADDR A:0x1b103b4
y.create.l HWIO_CAMSS_A_VFE_0_A_VFE_COLOR_CORRECT_COEFF_Q_ADDR A:0x1b103b8
y.create.l HWIO_CAMSS_A_VFE_0_A_VFE_LUT_BANK_SEL_ADDR A:0x1b103bc
y.create.l HWIO_CAMSS_A_VFE_0_A_VFE_LA_CFG_ADDR A:0x1b103c0
y.create.l HWIO_CAMSS_A_VFE_0_A_VFE_COLOR_CONVERT_COEFF_0_ADDR A:0x1b103c4
y.create.l HWIO_CAMSS_A_VFE_0_A_VFE_COLOR_CONVERT_COEFF_1_ADDR A:0x1b103c8
y.create.l HWIO_CAMSS_A_VFE_0_A_VFE_COLOR_CONVERT_COEFF_2_ADDR A:0x1b103cc
y.create.l HWIO_CAMSS_A_VFE_0_A_VFE_COLOR_CONVERT_OFFSET_ADDR A:0x1b103d0
y.create.l HWIO_CAMSS_A_VFE_0_A_VFE_CHROMA_ENHAN_A_ADDR A:0x1b103d4
y.create.l HWIO_CAMSS_A_VFE_0_A_VFE_CHROMA_ENHAN_B_ADDR A:0x1b103d8
y.create.l HWIO_CAMSS_A_VFE_0_A_VFE_CHROMA_ENHAN_C_ADDR A:0x1b103dc
y.create.l HWIO_CAMSS_A_VFE_0_A_VFE_CHROMA_ENHAN_D_ADDR A:0x1b103e0
y.create.l HWIO_CAMSS_A_VFE_0_A_VFE_CHROMA_ENHAN_K_ADDR A:0x1b103e4
y.create.l HWIO_CAMSS_A_VFE_0_A_VFE_CHROMA_SUPPRESS_CFG_0_ADDR A:0x1b103e8
y.create.l HWIO_CAMSS_A_VFE_0_A_VFE_CHROMA_SUPPRESS_CFG_1_ADDR A:0x1b103ec
y.create.l HWIO_CAMSS_A_VFE_0_A_VFE_CHROMA_SUPPRESS_CFG_2_ADDR A:0x1b103f0
y.create.l HWIO_CAMSS_A_VFE_0_A_VFE_MCE_RED_CFG_0_ADDR A:0x1b103f4
y.create.l HWIO_CAMSS_A_VFE_0_A_VFE_MCE_RED_CFG_1_ADDR A:0x1b103f8
y.create.l HWIO_CAMSS_A_VFE_0_A_VFE_MCE_RED_CFG_2_ADDR A:0x1b103fc
y.create.l HWIO_CAMSS_A_VFE_0_A_VFE_MCE_GREEN_CFG_0_ADDR A:0x1b10400
y.create.l HWIO_CAMSS_A_VFE_0_A_VFE_MCE_GREEN_CFG_1_ADDR A:0x1b10404
y.create.l HWIO_CAMSS_A_VFE_0_A_VFE_MCE_GREEN_CFG_2_ADDR A:0x1b10408
y.create.l HWIO_CAMSS_A_VFE_0_A_VFE_MCE_BLUE_CFG_0_ADDR A:0x1b1040c
y.create.l HWIO_CAMSS_A_VFE_0_A_VFE_MCE_BLUE_CFG_1_ADDR A:0x1b10410
y.create.l HWIO_CAMSS_A_VFE_0_A_VFE_MCE_BLUE_CFG_2_ADDR A:0x1b10414
y.create.l HWIO_CAMSS_A_VFE_0_A_VFE_SKIN_ENHAN_CR_COORD_0_ADDR A:0x1b10418
y.create.l HWIO_CAMSS_A_VFE_0_A_VFE_SKIN_ENHAN_CR_COORD_1_ADDR A:0x1b1041c
y.create.l HWIO_CAMSS_A_VFE_0_A_VFE_SKIN_ENHAN_CR_COORD_2_ADDR A:0x1b10420
y.create.l HWIO_CAMSS_A_VFE_0_A_VFE_SKIN_ENHAN_CR_COORD_3_ADDR A:0x1b10424
y.create.l HWIO_CAMSS_A_VFE_0_A_VFE_SKIN_ENHAN_CR_COORD_4_ADDR A:0x1b10428
y.create.l HWIO_CAMSS_A_VFE_0_A_VFE_SKIN_ENHAN_CB_COORD_0_ADDR A:0x1b1042c
y.create.l HWIO_CAMSS_A_VFE_0_A_VFE_SKIN_ENHAN_CB_COORD_1_ADDR A:0x1b10430
y.create.l HWIO_CAMSS_A_VFE_0_A_VFE_SKIN_ENHAN_CB_COORD_2_ADDR A:0x1b10434
y.create.l HWIO_CAMSS_A_VFE_0_A_VFE_SKIN_ENHAN_CB_COORD_3_ADDR A:0x1b10438
y.create.l HWIO_CAMSS_A_VFE_0_A_VFE_SKIN_ENHAN_CB_COORD_4_ADDR A:0x1b1043c
y.create.l HWIO_CAMSS_A_VFE_0_A_VFE_SKIN_ENHAN_CR_COEFF_0_ADDR A:0x1b10440
y.create.l HWIO_CAMSS_A_VFE_0_A_VFE_SKIN_ENHAN_CR_COEFF_1_ADDR A:0x1b10444
y.create.l HWIO_CAMSS_A_VFE_0_A_VFE_SKIN_ENHAN_CR_COEFF_2_ADDR A:0x1b10448
y.create.l HWIO_CAMSS_A_VFE_0_A_VFE_SKIN_ENHAN_CR_COEFF_3_ADDR A:0x1b1044c
y.create.l HWIO_CAMSS_A_VFE_0_A_VFE_SKIN_ENHAN_CR_COEFF_4_ADDR A:0x1b10450
y.create.l HWIO_CAMSS_A_VFE_0_A_VFE_SKIN_ENHAN_CR_COEFF_5_ADDR A:0x1b10454
y.create.l HWIO_CAMSS_A_VFE_0_A_VFE_SKIN_ENHAN_CB_COEFF_0_ADDR A:0x1b10458
y.create.l HWIO_CAMSS_A_VFE_0_A_VFE_SKIN_ENHAN_CB_COEFF_1_ADDR A:0x1b1045c
y.create.l HWIO_CAMSS_A_VFE_0_A_VFE_SKIN_ENHAN_CB_COEFF_2_ADDR A:0x1b10460
y.create.l HWIO_CAMSS_A_VFE_0_A_VFE_SKIN_ENHAN_CB_COEFF_3_ADDR A:0x1b10464
y.create.l HWIO_CAMSS_A_VFE_0_A_VFE_SKIN_ENHAN_CB_COEFF_4_ADDR A:0x1b10468
y.create.l HWIO_CAMSS_A_VFE_0_A_VFE_SKIN_ENHAN_CB_COEFF_5_ADDR A:0x1b1046c
y.create.l HWIO_CAMSS_A_VFE_0_A_VFE_SKIN_ENHAN_CR_OFFSET_0_ADDR A:0x1b10470
y.create.l HWIO_CAMSS_A_VFE_0_A_VFE_SKIN_ENHAN_CR_OFFSET_1_ADDR A:0x1b10474
y.create.l HWIO_CAMSS_A_VFE_0_A_VFE_SKIN_ENHAN_CR_OFFSET_2_ADDR A:0x1b10478
y.create.l HWIO_CAMSS_A_VFE_0_A_VFE_SKIN_ENHAN_CR_OFFSET_3_ADDR A:0x1b1047c
y.create.l HWIO_CAMSS_A_VFE_0_A_VFE_SKIN_ENHAN_CR_OFFSET_4_ADDR A:0x1b10480
y.create.l HWIO_CAMSS_A_VFE_0_A_VFE_SKIN_ENHAN_CR_OFFSET_5_ADDR A:0x1b10484
y.create.l HWIO_CAMSS_A_VFE_0_A_VFE_SKIN_ENHAN_CB_OFFSET_0_ADDR A:0x1b10488
y.create.l HWIO_CAMSS_A_VFE_0_A_VFE_SKIN_ENHAN_CB_OFFSET_1_ADDR A:0x1b1048c
y.create.l HWIO_CAMSS_A_VFE_0_A_VFE_SKIN_ENHAN_CB_OFFSET_2_ADDR A:0x1b10490
y.create.l HWIO_CAMSS_A_VFE_0_A_VFE_SKIN_ENHAN_CB_OFFSET_3_ADDR A:0x1b10494
y.create.l HWIO_CAMSS_A_VFE_0_A_VFE_SKIN_ENHAN_CB_OFFSET_4_ADDR A:0x1b10498
y.create.l HWIO_CAMSS_A_VFE_0_A_VFE_SKIN_ENHAN_CB_OFFSET_5_ADDR A:0x1b1049c
y.create.l HWIO_CAMSS_A_VFE_0_A_VFE_ASF_CFG_ADDR A:0x1b104a0
y.create.l HWIO_CAMSS_A_VFE_0_A_VFE_ASF_SHARP_CFG_0_ADDR A:0x1b104a4
y.create.l HWIO_CAMSS_A_VFE_0_A_VFE_ASF_SHARP_CFG_1_ADDR A:0x1b104a8
y.create.l HWIO_CAMSS_A_VFE_0_A_VFE_ASF_SHARP_COEFF_0_ADDR A:0x1b104ac
y.create.l HWIO_CAMSS_A_VFE_0_A_VFE_ASF_SHARP_COEFF_1_ADDR A:0x1b104b0
y.create.l HWIO_CAMSS_A_VFE_0_A_VFE_ASF_SHARP_COEFF_2_ADDR A:0x1b104b4
y.create.l HWIO_CAMSS_A_VFE_0_A_VFE_ASF_SHARP_COEFF_3_ADDR A:0x1b104b8
y.create.l HWIO_CAMSS_A_VFE_0_A_VFE_ASF_SHARP_COEFF_4_ADDR A:0x1b104bc
y.create.l HWIO_CAMSS_A_VFE_0_A_VFE_ASF_SHARP_COEFF_5_ADDR A:0x1b104c0
y.create.l HWIO_CAMSS_A_VFE_0_A_VFE_ASF_MAX_EDGE_ADDR A:0x1b104c4
y.create.l HWIO_CAMSS_A_VFE_0_A_VFE_ASF_CROP_WIDTH_CFG_ADDR A:0x1b104c8
y.create.l HWIO_CAMSS_A_VFE_0_A_VFE_ASF_CROP_HEIGHT_CFG_ADDR A:0x1b104cc
y.create.l HWIO_CAMSS_A_VFE_0_A_VFE_ASF_SPECIAL_EFX_CFG_ADDR A:0x1b105fc
y.create.l HWIO_CAMSS_A_VFE_0_A_VFE_SCALE_Y_CFG_ADDR A:0x1b104d0
y.create.l HWIO_CAMSS_A_VFE_0_A_VFE_SCALE_Y_H_IMAGE_SIZE_CFG_ADDR A:0x1b104d4
y.create.l HWIO_CAMSS_A_VFE_0_A_VFE_SCALE_Y_H_PHASE_CFG_ADDR A:0x1b104d8
y.create.l HWIO_CAMSS_A_VFE_0_A_VFE_SCALE_Y_V_IMAGE_SIZE_CFG_ADDR A:0x1b104dc
y.create.l HWIO_CAMSS_A_VFE_0_A_VFE_SCALE_Y_V_PHASE_CFG_ADDR A:0x1b104e0
y.create.l HWIO_CAMSS_A_VFE_0_A_VFE_SCALE_CBCR_CFG_ADDR A:0x1b104e4
y.create.l HWIO_CAMSS_A_VFE_0_A_VFE_SCALE_CBCR_H_IMAGE_SIZE_CFG_ADDR A:0x1b104e8
y.create.l HWIO_CAMSS_A_VFE_0_A_VFE_SCALE_CBCR_H_PHASE_CFG_ADDR A:0x1b104ec
y.create.l HWIO_CAMSS_A_VFE_0_A_VFE_SCALE_CBCR_V_IMAGE_SIZE_CFG_ADDR A:0x1b104f0
y.create.l HWIO_CAMSS_A_VFE_0_A_VFE_SCALE_CBCR_V_PHASE_CFG_ADDR A:0x1b104f4
y.create.l HWIO_CAMSS_A_VFE_0_A_VFE_CHROMA_SUBSAMPLE_CFG_ADDR A:0x1b104f8
y.create.l HWIO_CAMSS_A_VFE_0_A_VFE_CHROMA_SUB_CROP_WIDTH_CFG_ADDR A:0x1b104fc
y.create.l HWIO_CAMSS_A_VFE_0_A_VFE_CHROMA_SUB_CROP_HEIGHT_CFG_ADDR A:0x1b10500
y.create.l HWIO_CAMSS_A_VFE_0_A_VFE_FRAMEDROP_ENC_Y_CFG_ADDR A:0x1b10504
y.create.l HWIO_CAMSS_A_VFE_0_A_VFE_FRAMEDROP_ENC_CBCR_CFG_ADDR A:0x1b10508
y.create.l HWIO_CAMSS_A_VFE_0_A_VFE_FRAMEDROP_ENC_Y_PATTERN_ADDR A:0x1b1050c
y.create.l HWIO_CAMSS_A_VFE_0_A_VFE_FRAMEDROP_ENC_CBCR_PATTERN_ADDR A:0x1b10510
y.create.l HWIO_CAMSS_A_VFE_0_A_VFE_FRAMEDROP_VIEW_Y_CFG_ADDR A:0x1b10514
y.create.l HWIO_CAMSS_A_VFE_0_A_VFE_FRAMEDROP_VIEW_CBCR_CFG_ADDR A:0x1b10518
y.create.l HWIO_CAMSS_A_VFE_0_A_VFE_FRAMEDROP_VIEW_Y_PATTERN_ADDR A:0x1b1051c
y.create.l HWIO_CAMSS_A_VFE_0_A_VFE_FRAMEDROP_VIEW_CBCR_PATTERN_ADDR A:0x1b10520
y.create.l HWIO_CAMSS_A_VFE_0_A_VFE_CLAMP_MAX_CFG_ADDR A:0x1b10524
y.create.l HWIO_CAMSS_A_VFE_0_A_VFE_CLAMP_MIN_CFG_ADDR A:0x1b10528
y.create.l HWIO_CAMSS_A_VFE_0_A_VFE_REALIGN_BUF_CFG_ADDR A:0x1b1052c
y.create.l HWIO_CAMSS_A_VFE_0_A_VFE_STATS_CFG_ADDR A:0x1b10530
y.create.l HWIO_CAMSS_A_VFE_0_A_VFE_STATS_BG_RGN_OFFSET_CFG_ADDR A:0x1b10700
y.create.l HWIO_CAMSS_A_VFE_0_A_VFE_STATS_BG_RGN_SIZE_CFG_ADDR A:0x1b10704
y.create.l HWIO_CAMSS_A_VFE_0_A_VFE_STATS_BG_THRESHOLD_CFG_ADDR A:0x1b10708
y.create.l HWIO_CAMSS_A_VFE_0_A_VFE_STATS_BF_RGN_OFFSET_CFG_ADDR A:0x1b1070c
y.create.l HWIO_CAMSS_A_VFE_0_A_VFE_STATS_BF_RGN_SIZE_CFG_ADDR A:0x1b10710
y.create.l HWIO_CAMSS_A_VFE_0_A_VFE_STATS_BF_FILTER_CFG_0_ADDR A:0x1b10714
y.create.l HWIO_CAMSS_A_VFE_0_A_VFE_STATS_BF_FILTER_CFG_1_ADDR A:0x1b10718
y.create.l HWIO_CAMSS_A_VFE_0_A_VFE_STATS_BF_FILTER_COEFF_0_ADDR A:0x1b1071c
y.create.l HWIO_CAMSS_A_VFE_0_A_VFE_STATS_BF_FILTER_COEFF_1_ADDR A:0x1b10820
y.create.l HWIO_CAMSS_A_VFE_0_A_VFE_STATS_BF_FILTER_COEFF_2_ADDR A:0x1b10828
y.create.l HWIO_CAMSS_A_VFE_0_A_VFE_STATS_BF_FILTER_COEFF_3_ADDR A:0x1b10720
y.create.l HWIO_CAMSS_A_VFE_0_A_VFE_STATS_BF_FILTER_COEFF_4_ADDR A:0x1b10824
y.create.l HWIO_CAMSS_A_VFE_0_A_VFE_STATS_BF_FILTER_COEFF_5_ADDR A:0x1b1082c
y.create.l HWIO_CAMSS_A_VFE_0_A_VFE_STATS_BHIST_RGN_OFFSET_CFG_ADDR A:0x1b10724
y.create.l HWIO_CAMSS_A_VFE_0_A_VFE_STATS_BHIST_RGN_SIZE_CFG_ADDR A:0x1b10728
y.create.l HWIO_CAMSS_A_VFE_0_A_VFE_STATS_AE_RGN_OFFSET_CFG_ADDR A:0x1b10534
y.create.l HWIO_CAMSS_A_VFE_0_A_VFE_STATS_AE_RGN_SIZE_CFG_ADDR A:0x1b10538
y.create.l HWIO_CAMSS_A_VFE_0_A_VFE_STATS_AF_RGN_OFFSET_CFG_ADDR A:0x1b1053c
y.create.l HWIO_CAMSS_A_VFE_0_A_VFE_STATS_AF_RGN_SIZE_CFG_ADDR A:0x1b10540
y.create.l HWIO_CAMSS_A_VFE_0_A_VFE_STATS_AF_HPF_COEFF_0_ADDR A:0x1b10544
y.create.l HWIO_CAMSS_A_VFE_0_A_VFE_STATS_AF_HPF_COEFF_1_ADDR A:0x1b10548
y.create.l HWIO_CAMSS_A_VFE_0_A_VFE_STATS_AWB_RGN_OFFSET_CFG_ADDR A:0x1b1054c
y.create.l HWIO_CAMSS_A_VFE_0_A_VFE_STATS_AWB_RGN_SIZE_CFG_ADDR A:0x1b10550
y.create.l HWIO_CAMSS_A_VFE_0_A_VFE_STATS_AWB_SGW_CFG_ADDR A:0x1b10554
y.create.l HWIO_CAMSS_A_VFE_0_A_VFE_STATS_AWB_AGW_CFG_0_ADDR A:0x1b10558
y.create.l HWIO_CAMSS_A_VFE_0_A_VFE_STATS_AWB_AGW_CFG_1_ADDR A:0x1b1055c
y.create.l HWIO_CAMSS_A_VFE_0_A_VFE_STATS_AWB_AGW_CFG_2_ADDR A:0x1b10560
y.create.l HWIO_CAMSS_A_VFE_0_A_VFE_STATS_AWB_GX_CFG_0_ADDR A:0x1b10564
y.create.l HWIO_CAMSS_A_VFE_0_A_VFE_STATS_AWB_GX_CFG_1_ADDR A:0x1b10568
y.create.l HWIO_CAMSS_A_VFE_0_A_VFE_STATS_RS_RGN_OFFSET_CFG_ADDR A:0x1b1056c
y.create.l HWIO_CAMSS_A_VFE_0_A_VFE_STATS_RS_RGN_SIZE_CFG_ADDR A:0x1b10570
y.create.l HWIO_CAMSS_A_VFE_0_A_VFE_STATS_CS_RGN_OFFSET_CFG_ADDR A:0x1b10574
y.create.l HWIO_CAMSS_A_VFE_0_A_VFE_STATS_CS_RGN_SIZE_CFG_ADDR A:0x1b10578
y.create.l HWIO_CAMSS_A_VFE_0_A_VFE_STATS_IHIST_RGN_OFFSET_CFG_ADDR A:0x1b1057c
y.create.l HWIO_CAMSS_A_VFE_0_A_VFE_STATS_IHIST_RGN_SIZE_CFG_ADDR A:0x1b10580
y.create.l HWIO_CAMSS_A_VFE_0_A_VFE_STATS_SKIN_RGN_OFFSET_CFG_ADDR A:0x1b10584
y.create.l HWIO_CAMSS_A_VFE_0_A_VFE_STATS_SKIN_RGN_SIZE_CFG_ADDR A:0x1b10588
y.create.l HWIO_CAMSS_A_VFE_0_A_VFE_STATS_SKIN_HUE_CFG_ADDR A:0x1b1058c
y.create.l HWIO_CAMSS_A_VFE_0_A_VFE_STATS_SKIN_Y_CFG_ADDR A:0x1b10590
y.create.l HWIO_CAMSS_A_VFE_0_A_VFE_STATS_SKIN_CBCR_CFG_ADDR A:0x1b10594
y.create.l HWIO_CAMSS_A_VFE_0_A_VFE_DMI_CFG_ADDR A:0x1b10598
y.create.l HWIO_CAMSS_A_VFE_0_A_VFE_DMI_ADDR_ADDR A:0x1b1059c
y.create.l HWIO_CAMSS_A_VFE_0_A_VFE_DMI_DATA_HI_ADDR A:0x1b105a0
y.create.l HWIO_CAMSS_A_VFE_0_A_VFE_DMI_DATA_LO_ADDR A:0x1b105a4
y.create.l HWIO_CAMSS_A_VFE_0_A_VFE_DMI_RAM_AUTO_LOAD_CMD_ADDR A:0x1b105a8
y.create.l HWIO_CAMSS_A_VFE_0_A_VFE_DMI_RAM_AUTO_LOAD_STATUS_ADDR A:0x1b105ac
y.create.l HWIO_CAMSS_A_VFE_0_A_VFE_DMI_RAM_AUTO_LOAD_CFG_ADDR A:0x1b105b0
y.create.l HWIO_CAMSS_A_VFE_0_A_VFE_DMI_RAM_AUTO_LOAD_SEED_ADDR A:0x1b105b4
y.create.l HWIO_CAMSS_A_VFE_0_A_VFE_TESTBUS_SEL_ADDR A:0x1b105b8
y.create.l HWIO_CAMSS_A_VFE_0_A_VFE_TESTGEN_CFG_ADDR A:0x1b105bc
y.create.l HWIO_CAMSS_A_VFE_0_A_VFE_SW_TESTGEN_CMD_ADDR A:0x1b105c0
y.create.l HWIO_CAMSS_A_VFE_0_A_VFE_HW_TESTGEN_CMD_ADDR A:0x1b105c4
y.create.l HWIO_CAMSS_A_VFE_0_A_VFE_HW_TESTGEN_CFG_ADDR A:0x1b105c8
y.create.l HWIO_CAMSS_A_VFE_0_A_VFE_HW_TESTGEN_IMAGE_CFG_ADDR A:0x1b105cc
y.create.l HWIO_CAMSS_A_VFE_0_A_VFE_HW_TESTGEN_SOF_OFFSET_CFG_ADDR A:0x1b105d0
y.create.l HWIO_CAMSS_A_VFE_0_A_VFE_HW_TESTGEN_EOF_NOFFSET_CFG_ADDR A:0x1b105d4
y.create.l HWIO_CAMSS_A_VFE_0_A_VFE_HW_TESTGEN_SOL_OFFSET_CFG_ADDR A:0x1b105d8
y.create.l HWIO_CAMSS_A_VFE_0_A_VFE_HW_TESTGEN_EOL_NOFFSET_CFG_ADDR A:0x1b105dc
y.create.l HWIO_CAMSS_A_VFE_0_A_VFE_HW_TESTGEN_HBI_CFG_ADDR A:0x1b105e0
y.create.l HWIO_CAMSS_A_VFE_0_A_VFE_HW_TESTGEN_VBL_CFG_ADDR A:0x1b105e4
y.create.l HWIO_CAMSS_A_VFE_0_A_VFE_HW_TESTGEN_COLOR_BARS_CFG_ADDR A:0x1b105f0
y.create.l HWIO_CAMSS_A_VFE_0_A_VFE_HW_TESTGEN_RANDOM_CFG_ADDR A:0x1b105f4
y.create.l HWIO_CAMSS_A_VFE_0_A_VFE_SPARE_ADDR A:0x1b105f8
y.create.l HWIO_CAMSS_A_VFE_0_A_VFE_CE_CLOCK_CONFIG_ADDR A:0x1b10f60
y.create.l HWIO_CAMSS_A_VFE_0_A_VFE_CE_SW_RESET_ADDR A:0x1b10f64
y.create.l HWIO_CAMSS_A_VFE_0_A_VFE_CE_ENABLE_ADDR A:0x1b10f68
y.create.l HWIO_CAMSS_A_VFE_0_A_VFE_CE_CMD_BUFFER_ENABLE_ADDR A:0x1b10f6c
y.create.l HWIO_CAMSS_A_VFE_0_A_VFE_CE_CMD_BUFFER_A_ADDR_ADDR A:0x1b10f70
y.create.l HWIO_CAMSS_A_VFE_0_A_VFE_CE_CMD_BUFFER_B_ADDR_ADDR A:0x1b10f74
y.create.l HWIO_CAMSS_A_VFE_0_A_VFE_CE_INTR_STATUS_ADDR A:0x1b10f78
y.create.l HWIO_CAMSS_A_VFE_0_A_VFE_CE_INTR_CLEAR_ADDR A:0x1b10f7c
y.create.l HWIO_CAMSS_A_VFE_0_A_VFE_CE_BUFFER_STATUS_ADDR A:0x1b10f80
y.create.l HWIO_CAMSS_A_VFE_0_A_VFE_CE_STATE_STATUS_ADDR A:0x1b10f84
y.create.l HWIO_CAMSS_A_VFE_0_A_VFE_CE_CURRENT_PTR_ADDR A:0x1b10f88
y.create.l HWIO_CAMSS_A_VFE_0_A_VFE_CE_PING_PONG_BUF_COUNT_ADDR A:0x1b10f8c
y.create.l HWIO_CAMSS_A_VFE_0_A_VFE_CE_CYCLE_COUNT_ADDR A:0x1b10f90
y.create.l HWIO_CAMSS_A_VFE_0_A_VFE_CE_MAX_PING_PONG_BUF_CYCLE_COUNT_ADDR A:0x1b10f94
y.create.l HWIO_CAMSS_A_VFE_0_A_VFE_CE_CMD_COUNT_ADDR A:0x1b10f98
y.create.l HWIO_CAMSS_A_VFE_0_A_VFE_CE_CMD_BUF_CYC_COUNT_ADDR A:0x1b10f9c
y.create.l HWIO_CAMSS_A_VFE_0_A_VFE_CE_PENDING_COMMAND_ADDR A:0x1b10fa0
y.create.l HWIO_CAMSS_A_VFE_0_A_VFE_CE_PENDING_CMD_DATA1_ADDR A:0x1b10fa4
y.create.l HWIO_CAMSS_A_VFE_0_A_VFE_CE_PENDING_CMD_DATA2_ADDR A:0x1b10fa8
y.create.l HWIO_CAMSS_A_VFE_0_A_VFE_CE_PENDING_CMD_DATA3_ADDR A:0x1b10fac
y.create.l HWIO_CAMSS_A_VFE_0_A_VFE_CE_EXE_COMMAND_ADDR A:0x1b10fb0
y.create.l HWIO_CAMSS_A_VFE_0_A_VFE_CE_EXE_CMD_DATA1_ADDR A:0x1b10fb4
y.create.l HWIO_CAMSS_A_VFE_0_A_VFE_CE_EXE_CMD_DATA2_ADDR A:0x1b10fb8
y.create.l HWIO_CAMSS_A_VFE_0_A_VFE_CE_EXE_CMD_DATA3_ADDR A:0x1b10fbc
y.create.l HWIO_CAMSS_A_VFE_0_A_VFE_CE_TESTBUS_OBSERVE_ADDR A:0x1b10fc0
y.create.l HWIO_CAMSS_A_VFE_0_A_VFE_CE_TEST_BUS_SEL_ADDR A:0x1b10fc4
y.create.l HWIO_CAMSS_A_VFE_0_A_VFE_CE_EXECUTE_NEXT_CMD_ADDR A:0x1b10fc8
y.create.l HWIO_CAMSS_A_VFE_0_A_VFE_CE_AXI_RD_THROTTLE_DIS_ADDR A:0x1b10fcc
y.create.l HWIO_CAMSS_A_VFE_0_A_VFE_CE_ARB_OVERRIDE_ADDR A:0x1b10fd0
y.create.l HWIO_CAMSS_A_VFE_0_A_VFE_CE_SPARE_ADDR A:0x1b10fd4
y.create.l HWIO_CAMSS_A_VFE_0_A_VFE_CE_PING_PONG_BUF_COUNT_STAT_ADDR A:0x1b10fe0
y.create.l HWIO_CAMSS_A_VFE_0_A_VFE_CE_CYCLE_COUNT_STAT_ADDR A:0x1b10fe4
y.create.l HWIO_CAMSS_A_VFE_0_A_VFE_CE_MAX_PING_PONG_BUF_CYCLE_COUNT_STAT_ADDR A:0x1b10fe8
y.create.l HWIO_CAMSS_A_VFE_0_A_VFE_CE_CMD_COUNT_STAT_ADDR A:0x1b10fec
y.create.l HWIO_CAMSS_A_VFE_0_A_VFE_CE_CMD_BUF_CYC_COUNT_STAT_ADDR A:0x1b10ff0
y.create.l HWIO_CAMSS_A_VBIF_VFE_VBIF_VERSION_ADDR A:0x1b40000
y.create.l HWIO_CAMSS_A_VBIF_VFE_VBIF_CLKON_ADDR A:0x1b40004
y.create.l HWIO_CAMSS_A_VBIF_VFE_VBIF_CLK_FORCE_CTRL0_ADDR A:0x1b40008
y.create.l HWIO_CAMSS_A_VBIF_VFE_VBIF_CLK_FORCE_CTRL1_ADDR A:0x1b4000c
y.create.l HWIO_CAMSS_A_VBIF_VFE_VBIF_QOS_OVERRIDE_EN_ADDR A:0x1b40010
y.create.l HWIO_CAMSS_A_VBIF_VFE_VBIF_PRILVL_ACT_PROP_EN_ADDR A:0x1b40014
y.create.l HWIO_CAMSS_A_VBIF_VFE_VBIF_QOS_OVERRIDE_REQPRI_ADDR A:0x1b40018
y.create.l HWIO_CAMSS_A_VBIF_VFE_VBIF_QOS_OVERRIDE_PRILVL_ADDR A:0x1b4001c
y.create.l HWIO_CAMSS_A_VBIF_VFE_VBIF_QOS_REMAP_00_ADDR A:0x1b40020
y.create.l HWIO_CAMSS_A_VBIF_VFE_VBIF_QOS_REMAP_01_ADDR A:0x1b40024
y.create.l HWIO_CAMSS_A_VBIF_VFE_VBIF_QOS_REMAP_10_ADDR A:0x1b40028
y.create.l HWIO_CAMSS_A_VBIF_VFE_VBIF_QOS_REMAP_11_ADDR A:0x1b4002c
y.create.l HWIO_CAMSS_A_VBIF_VFE_VBIF_IN_RD_LIM_CONF0_ADDR A:0x1b400b0
y.create.l HWIO_CAMSS_A_VBIF_VFE_VBIF_IN_WR_LIM_CONF0_ADDR A:0x1b400c0
y.create.l HWIO_CAMSS_A_VBIF_VFE_VBIF_OUT_RD_LIM_CONF0_ADDR A:0x1b400d0
y.create.l HWIO_CAMSS_A_VBIF_VFE_VBIF_OUT_WR_LIM_CONF0_ADDR A:0x1b400d4
y.create.l HWIO_CAMSS_A_VBIF_VFE_VBIF_DDR_OUT_MAX_BURST_ADDR A:0x1b400d8
y.create.l HWIO_CAMSS_A_VBIF_VFE_VBIF_ISO_SYNC_ADDR A:0x1b400e0
y.create.l HWIO_CAMSS_A_VBIF_VFE_VBIF_ARB_CTL_ADDR A:0x1b400f0
y.create.l HWIO_CAMSS_A_VBIF_VFE_VBIF_DDR_ARB_CONF0_ADDR A:0x1b400f4
y.create.l HWIO_CAMSS_A_VBIF_VFE_VBIF_FIXED_ARB_CONF0_ADDR A:0x1b40100
y.create.l HWIO_CAMSS_A_VBIF_VFE_VBIF_ROUND_ROBIN_QOS_ARB_ADDR A:0x1b40124
y.create.l HWIO_CAMSS_A_VBIF_VFE_VBIF_OUT_AXI_AMEMTYPE_CONF0_ADDR A:0x1b40160
y.create.l HWIO_CAMSS_A_VBIF_VFE_VBIF_OUT_AXI_AINST_OVERRIDE_EN_ADDR A:0x1b40168
y.create.l HWIO_CAMSS_A_VBIF_VFE_VBIF_OUT_AXI_AINST_ADDR A:0x1b4016c
y.create.l HWIO_CAMSS_A_VBIF_VFE_VBIF_OUT_AXI_ASHARED_ADDR A:0x1b40170
y.create.l HWIO_CAMSS_A_VBIF_VFE_VBIF_OUT_AXI_AINNERSHARED_ADDR A:0x1b40174
y.create.l HWIO_CAMSS_A_VBIF_VFE_VBIF_OUT_AXI_AOOO_EN_ADDR A:0x1b40178
y.create.l HWIO_CAMSS_A_VBIF_VFE_VBIF_OUT_AXI_AOOO_ADDR A:0x1b4017c
y.create.l HWIO_CAMSS_A_VBIF_VFE_VBIF_OUT_AXI_ANOALLOCATE_ADDR A:0x1b40180
y.create.l HWIO_CAMSS_A_VBIF_VFE_VBIF_WD_TIMEOUT_ADDR A:0x1b40184
y.create.l HWIO_CAMSS_A_VBIF_VFE_VBIF_PND_ERR_ADDR A:0x1b40190
y.create.l HWIO_CAMSS_A_VBIF_VFE_VBIF_SRC_ERR_ADDR A:0x1b40194
y.create.l HWIO_CAMSS_A_VBIF_VFE_VBIF_ERR_MASK_ADDR A:0x1b40198
y.create.l HWIO_CAMSS_A_VBIF_VFE_VBIF_ERR_CLR_ADDR A:0x1b4019c
y.create.l HWIO_CAMSS_A_VBIF_VFE_VBIF_ERR_INFO_ADDR A:0x1b401a0
y.create.l HWIO_CAMSS_A_VBIF_VFE_VBIF_AXI_TEST_CTL_ADDR A:0x1b401b0
y.create.l HWIO_CAMSS_A_VBIF_VFE_VBIF_AXI_TEST_OUT_ADDR A:0x1b401b4
y.create.l HWIO_CAMSS_A_VBIF_VFE_VBIF_XIN_HALT_CTRL0_ADDR A:0x1b40200
y.create.l HWIO_CAMSS_A_VBIF_VFE_VBIF_XIN_HALT_CTRL1_ADDR A:0x1b40204
y.create.l HWIO_CAMSS_A_VBIF_VFE_VBIF_AXI_HALT_CTRL0_ADDR A:0x1b40208
y.create.l HWIO_CAMSS_A_VBIF_VFE_VBIF_AXI_HALT_CTRL1_ADDR A:0x1b4020c
y.create.l HWIO_CAMSS_A_VBIF_VFE_VBIF_TEST_BUS_OUT_CTRL_ADDR A:0x1b40210
y.create.l HWIO_CAMSS_A_VBIF_VFE_VBIF_TEST_BUS1_CTRL0_ADDR A:0x1b40214
y.create.l HWIO_CAMSS_A_VBIF_VFE_VBIF_TEST_BUS1_CTRL1_ADDR A:0x1b40218
y.create.l HWIO_CAMSS_A_VBIF_VFE_VBIF_TEST_BUS2_CTRL0_ADDR A:0x1b4021c
y.create.l HWIO_CAMSS_A_VBIF_VFE_VBIF_TEST_BUS2_CTRL1_ADDR A:0x1b40220
y.create.l HWIO_CAMSS_A_VBIF_VFE_VBIF_TEST_BUS_AHB_CTRL_ADDR A:0x1b4022c
y.create.l HWIO_CAMSS_A_VBIF_VFE_VBIF_TEST_BUS_OUT_ADDR A:0x1b40230
y.create.l HWIO_CAMSS_A_VBIF_VFE_VBIF_ATB_CONF0_ADDR A:0x1b40240
y.create.l HWIO_CAMSS_A_VBIF_VFE_VBIF_ATB_CONF1_ADDR A:0x1b40244
y.create.l HWIO_CAMSS_A_VBIF_VFE_VBIF_ATB_CONF2_ADDR A:0x1b40248
y.create.l HWIO_CAMSS_A_VBIF_VFE_VBIF_ATB_CONF3_ADDR A:0x1b4024c
y.create.l HWIO_CAMSS_A_VBIF_VFE_VBIF_ATB_TEST_VALUE_ADDR A:0x1b40250
y.create.l HWIO_CAMSS_A_VBIF_VFE_VBIF_STM_CONF_ADDR A:0x1b40260
y.create.l HWIO_CAMSS_A_VBIF_VFE_VBIF_WR_BUF_FOR_AP_ADDR A:0x1b40270
y.create.l HWIO_CAMSS_A_VBIF_VFE_VBIF_PERF_CNT_EN0_ADDR A:0x1b40300
y.create.l HWIO_CAMSS_A_VBIF_VFE_VBIF_PERF_CNT_EN1_ADDR A:0x1b40304
y.create.l HWIO_CAMSS_A_VBIF_VFE_VBIF_PERF_CNT_EN2_ADDR A:0x1b40308
y.create.l HWIO_CAMSS_A_VBIF_VFE_VBIF_PERF_CNT_EN3_ADDR A:0x1b4030c
y.create.l HWIO_CAMSS_A_VBIF_VFE_VBIF_PERF_CNT_CLR0_ADDR A:0x1b40320
y.create.l HWIO_CAMSS_A_VBIF_VFE_VBIF_PERF_CNT_CLR1_ADDR A:0x1b40324
y.create.l HWIO_CAMSS_A_VBIF_VFE_VBIF_PERF_CNT_CLR2_ADDR A:0x1b40328
y.create.l HWIO_CAMSS_A_VBIF_VFE_VBIF_PERF_CNT_CLR3_ADDR A:0x1b4032c
y.create.l HWIO_CAMSS_A_VBIF_VFE_VBIF_PERF_CNT_SEL0_ADDR A:0x1b40340
y.create.l HWIO_CAMSS_A_VBIF_VFE_VBIF_PERF_CNT_SEL1_ADDR A:0x1b40344
y.create.l HWIO_CAMSS_A_VBIF_VFE_VBIF_PERF_CNT_SEL2_ADDR A:0x1b40348
y.create.l HWIO_CAMSS_A_VBIF_VFE_VBIF_PERF_CNT_SEL3_ADDR A:0x1b4034c
y.create.l HWIO_CAMSS_A_VBIF_VFE_VBIF_PERF_CNT_L0_ADDR A:0x1b40360
y.create.l HWIO_CAMSS_A_VBIF_VFE_VBIF_PERF_CNT_L1_ADDR A:0x1b40364
y.create.l HWIO_CAMSS_A_VBIF_VFE_VBIF_PERF_CNT_L2_ADDR A:0x1b40368
y.create.l HWIO_CAMSS_A_VBIF_VFE_VBIF_PERF_CNT_L3_ADDR A:0x1b4036c
y.create.l HWIO_CAMSS_A_VBIF_VFE_VBIF_PERF_CNT_H0_ADDR A:0x1b40380
y.create.l HWIO_CAMSS_A_VBIF_VFE_VBIF_PERF_CNT_H1_ADDR A:0x1b40384
y.create.l HWIO_CAMSS_A_VBIF_VFE_VBIF_PERF_CNT_H2_ADDR A:0x1b40388
y.create.l HWIO_CAMSS_A_VBIF_VFE_VBIF_PERF_CNT_H3_ADDR A:0x1b4038c
y.create.l HWIO_CAMSS_A_VBIF_VFE_VBIF_PERF_PWR_CNT_EN0_ADDR A:0x1b40400
y.create.l HWIO_CAMSS_A_VBIF_VFE_VBIF_PERF_PWR_CNT_EN1_ADDR A:0x1b40404
y.create.l HWIO_CAMSS_A_VBIF_VFE_VBIF_PERF_PWR_CNT_EN2_ADDR A:0x1b40408
y.create.l HWIO_CAMSS_A_VBIF_VFE_VBIF_PERF_PWR_CNT_CLR0_ADDR A:0x1b40420
y.create.l HWIO_CAMSS_A_VBIF_VFE_VBIF_PERF_PWR_CNT_CLR1_ADDR A:0x1b40424
y.create.l HWIO_CAMSS_A_VBIF_VFE_VBIF_PERF_PWR_CNT_CLR2_ADDR A:0x1b40428
y.create.l HWIO_CAMSS_A_VBIF_VFE_VBIF_PERF_PWR_CNT_L0_ADDR A:0x1b40440
y.create.l HWIO_CAMSS_A_VBIF_VFE_VBIF_PERF_PWR_CNT_L1_ADDR A:0x1b40444
y.create.l HWIO_CAMSS_A_VBIF_VFE_VBIF_PERF_PWR_CNT_L2_ADDR A:0x1b40448
y.create.l HWIO_CAMSS_A_VBIF_VFE_VBIF_PERF_PWR_CNT_H0_ADDR A:0x1b40460
y.create.l HWIO_CAMSS_A_VBIF_VFE_VBIF_PERF_PWR_CNT_H1_ADDR A:0x1b40464
y.create.l HWIO_CAMSS_A_VBIF_VFE_VBIF_PERF_PWR_CNT_H2_ADDR A:0x1b40468
y.create.l HWIO_CAMSS_A_VBIF_VFE_VBIF_MISR_CFG_A0_ADDR A:0x1b40480
y.create.l HWIO_CAMSS_A_VBIF_VFE_VBIF_MISR_COUNTER_ADDR A:0x1b40490
y.create.l HWIO_CAMSS_A_VBIF_VFE_VBIF_MISR_CLR_A0_ADDR A:0x1b40494
y.create.l HWIO_CAMSS_A_VBIF_VFE_VBIF_MISR_A0_SIG0_ADDR A:0x1b404a4
y.create.l HWIO_CAMSS_A_VBIF_VFE_VBIF_MISR_A0_SIG1_ADDR A:0x1b404a8
y.create.l HWIO_CAMSS_A_VBIF_VFE_VBIF_MISR_A0_SIG2_ADDR A:0x1b404ac
y.create.l HWIO_CAMSS_A_VBIF_VFE_VBIF_MISR_A0_SIG3_ADDR A:0x1b404b0
y.create.l HWIO_CAMSS_A_VBIF_VFE_VBIF_ATB_EN_ADDR A:0x1b41030
y.create.l HWIO_CAMSS_A_VBIF_VFE_VBIF_STM_EN_ADDR A:0x1b41040
y.create.l HWIO_CAMSS_A_VBIF_VFE_VBIF_DDR_OUTPUT_RECOVERABLE_HALT_CTRL0_ADDR A:0x1b42000
y.create.l HWIO_CAMSS_A_VBIF_VFE_VBIF_DDR_OUTPUT_RECOVERABLE_HALT_CTRL1_ADDR A:0x1b42004
y.create.l HWIO_GCC_GPLL0_MODE_ADDR A:0x1821000
y.create.l HWIO_GCC_GPLL0_L_VAL_ADDR A:0x1821004
y.create.l HWIO_GCC_GPLL0_ALPHA_VAL_ADDR A:0x1821008
y.create.l HWIO_GCC_GPLL0_ALPHA_VAL_U_ADDR A:0x182100c
y.create.l HWIO_GCC_GPLL0_USER_CTL_ADDR A:0x1821010
y.create.l HWIO_GCC_GPLL0_USER_CTL_U_ADDR A:0x1821014
y.create.l HWIO_GCC_GPLL0_CONFIG_CTL_ADDR A:0x1821018
y.create.l HWIO_GCC_GPLL0_TEST_CTL_ADDR A:0x182101c
y.create.l HWIO_GCC_GPLL0_TEST_CTL_U_ADDR A:0x1821020
y.create.l HWIO_GCC_GPLL0_STATUS_ADDR A:0x1821024
y.create.l HWIO_GCC_GPLL0_FREQ_CTL_ADDR A:0x1821028
y.create.l HWIO_GCC_GPLL1_MODE_ADDR A:0x1820000
y.create.l HWIO_GCC_GPLL1_L_VAL_ADDR A:0x1820004
y.create.l HWIO_GCC_GPLL1_M_VAL_ADDR A:0x1820008
y.create.l HWIO_GCC_GPLL1_N_VAL_ADDR A:0x182000c
y.create.l HWIO_GCC_GPLL1_USER_CTL_ADDR A:0x1820010
y.create.l HWIO_GCC_GPLL1_CONFIG_CTL_ADDR A:0x1820014
y.create.l HWIO_GCC_GPLL1_TEST_CTL_ADDR A:0x1820018
y.create.l HWIO_GCC_GPLL1_STATUS_ADDR A:0x182001c
y.create.l HWIO_GCC_GPLL2_MODE_ADDR A:0x1825000
y.create.l HWIO_GCC_GPLL2_L_VAL_ADDR A:0x1825004
y.create.l HWIO_GCC_GPLL2_ALPHA_VAL_ADDR A:0x1825008
y.create.l HWIO_GCC_GPLL2_ALPHA_VAL_U_ADDR A:0x182500c
y.create.l HWIO_GCC_GPLL2_USER_CTL_ADDR A:0x1825010
y.create.l HWIO_GCC_GPLL2_USER_CTL_U_ADDR A:0x1825014
y.create.l HWIO_GCC_GPLL2_CONFIG_CTL_ADDR A:0x1825018
y.create.l HWIO_GCC_GPLL2_TEST_CTL_ADDR A:0x182501c
y.create.l HWIO_GCC_GPLL2_TEST_CTL_U_ADDR A:0x1825020
y.create.l HWIO_GCC_GPLL2_STATUS_ADDR A:0x1825024
y.create.l HWIO_GCC_GPLL2_FREQ_CTL_ADDR A:0x1825028
y.create.l HWIO_GCC_BIMC_PLL_MODE_ADDR A:0x1823000
y.create.l HWIO_GCC_BIMC_PLL_L_VAL_ADDR A:0x1823004
y.create.l HWIO_GCC_BIMC_PLL_ALPHA_VAL_ADDR A:0x1823008
y.create.l HWIO_GCC_BIMC_PLL_ALPHA_VAL_U_ADDR A:0x182300c
y.create.l HWIO_GCC_BIMC_PLL_USER_CTL_ADDR A:0x1823010
y.create.l HWIO_GCC_BIMC_PLL_USER_CTL_U_ADDR A:0x1823014
y.create.l HWIO_GCC_BIMC_PLL_CONFIG_CTL_ADDR A:0x1823018
y.create.l HWIO_GCC_BIMC_PLL_TEST_CTL_ADDR A:0x182301c
y.create.l HWIO_GCC_BIMC_PLL_TEST_CTL_U_ADDR A:0x1823020
y.create.l HWIO_GCC_BIMC_PLL_STATUS_ADDR A:0x1823024
y.create.l HWIO_GCC_BIMC_PLL_FREQ_CTL_ADDR A:0x1823028
y.create.l HWIO_GCC_SYSTEM_NOC_BCR_ADDR A:0x1826000
y.create.l HWIO_GCC_SYSTEM_NOC_BFDCD_CMD_RCGR_ADDR A:0x1826004
y.create.l HWIO_GCC_SYSTEM_NOC_BFDCD_CFG_RCGR_ADDR A:0x1826008
y.create.l HWIO_GCC_SNOC_QOSGEN_EXTREF_CTL_ADDR A:0x182601c
y.create.l HWIO_GCC_PCNOC_BFDCD_CMD_RCGR_ADDR A:0x1827000
y.create.l HWIO_GCC_PCNOC_BFDCD_CFG_RCGR_ADDR A:0x1827004
y.create.l HWIO_GCC_SYS_NOC_AXI_CBCR_ADDR A:0x1826020
y.create.l HWIO_GCC_SYS_NOC_QDSS_STM_AXI_CBCR_ADDR A:0x1826024
y.create.l HWIO_GCC_SYS_NOC_APSS_AHB_CBCR_ADDR A:0x1826028
y.create.l HWIO_GCC_SNOC_PCNOC_AHB_CBCR_ADDR A:0x182602c
y.create.l HWIO_GCC_SYS_NOC_AT_CBCR_ADDR A:0x1826030
y.create.l HWIO_GCC_PCNOC_BCR_ADDR A:0x1827018
y.create.l HWIO_GCC_PCNOC_AHB_CBCR_ADDR A:0x182701c
y.create.l HWIO_GCC_PCNOC_DDR_CFG_CBCR_ADDR A:0x1832024
y.create.l HWIO_GCC_PCNOC_RPM_AHB_CBCR_ADDR A:0x1827024
y.create.l HWIO_GCC_PCNOC_AT_CBCR_ADDR A:0x1827028
y.create.l HWIO_GCC_NOC_CONF_XPU_AHB_CBCR_ADDR A:0x1817000
y.create.l HWIO_GCC_IMEM_BCR_ADDR A:0x180e000
y.create.l HWIO_GCC_IMEM_AXI_CBCR_ADDR A:0x180e004
y.create.l HWIO_GCC_IMEM_CFG_AHB_CBCR_ADDR A:0x180e008
y.create.l HWIO_GCC_MMSS_BCR_ADDR A:0x184b000
y.create.l HWIO_GCC_BIMC_GFX_CBCR_ADDR A:0x1831024
Y.CREATE.L HWIO_GCC_MSS_CFG_AHB_CBCR_CLK_ENABLE_BMSK 0x1
Y.CREATE.L HWIO_GCC_MSS_CFG_AHB_CBCR_CLK_ENABLE_SHFT 0x0
y.create.l HWIO_GCC_MSS_CFG_AHB_CBCR_ADDR A:0x1849000
y.create.l HWIO_GCC_MSS_Q6_BIMC_AXI_CBCR_ADDR A:0x1849004
y.create.l HWIO_GCC_RPM_CFG_XPU_CBCR_ADDR A:0x1817004
y.create.l HWIO_GCC_QDSS_BCR_ADDR A:0x1829000
y.create.l HWIO_GCC_QDSS_DAP_AHB_CBCR_ADDR A:0x1829004
y.create.l HWIO_GCC_QDSS_CFG_AHB_CBCR_ADDR A:0x1829008
y.create.l HWIO_GCC_QDSS_AT_CMD_RCGR_ADDR A:0x182900c
y.create.l HWIO_GCC_QDSS_AT_CFG_RCGR_ADDR A:0x1829010
y.create.l HWIO_GCC_QDSS_AT_CBCR_ADDR A:0x1829024
y.create.l HWIO_GCC_QDSS_ETR_USB_CBCR_ADDR A:0x1829028
y.create.l HWIO_GCC_QDSS_STM_CMD_RCGR_ADDR A:0x182902c
y.create.l HWIO_GCC_QDSS_STM_CFG_RCGR_ADDR A:0x1829030
y.create.l HWIO_GCC_QDSS_STM_CBCR_ADDR A:0x1829044
y.create.l HWIO_GCC_QDSS_TRACECLKIN_CMD_RCGR_ADDR A:0x1829048
y.create.l HWIO_GCC_QDSS_TRACECLKIN_CFG_RCGR_ADDR A:0x182904c
y.create.l HWIO_GCC_QDSS_TRACECLKIN_CBCR_ADDR A:0x1829060
y.create.l HWIO_GCC_QDSS_TSCTR_CMD_RCGR_ADDR A:0x1829064
y.create.l HWIO_GCC_QDSS_TSCTR_CFG_RCGR_ADDR A:0x1829068
y.create.l HWIO_GCC_QDSS_TSCTR_DIV2_CBCR_ADDR A:0x182907c
y.create.l HWIO_GCC_QDSS_TSCTR_DIV3_CBCR_ADDR A:0x1829080
y.create.l HWIO_GCC_QDSS_DAP_CBCR_ADDR A:0x1829084
y.create.l HWIO_GCC_QDSS_TSCTR_DIV4_CBCR_ADDR A:0x1829088
y.create.l HWIO_GCC_QDSS_TSCTR_DIV8_CBCR_ADDR A:0x182908c
y.create.l HWIO_GCC_QDSS_TSCTR_DIV16_CBCR_ADDR A:0x1829090
y.create.l HWIO_GCC_QPIC_BCR_ADDR A:0x183f000
y.create.l HWIO_GCC_QPIC_CMD_RCGR_ADDR A:0x183f004
y.create.l HWIO_GCC_QPIC_CFG_RCGR_ADDR A:0x183f008
y.create.l HWIO_GCC_QPIC_M_ADDR A:0x183f00c
y.create.l HWIO_GCC_QPIC_N_ADDR A:0x183f010
y.create.l HWIO_GCC_QPIC_D_ADDR A:0x183f014
y.create.l HWIO_GCC_QPIC_CBCR_ADDR A:0x183f018
y.create.l HWIO_GCC_QPIC_AHB_CBCR_ADDR A:0x183f01c
y.create.l HWIO_GCC_QPIC_SYSTEM_CBCR_ADDR A:0x183f020
y.create.l HWIO_GCC_GCC_SLEEP_CMD_RCGR_ADDR A:0x1830000
y.create.l HWIO_GCC_USB_HS_BCR_ADDR A:0x1841000
y.create.l HWIO_GCC_USB_HS_SYSTEM_CBCR_ADDR A:0x1841004
y.create.l HWIO_GCC_USB_HS_AHB_CBCR_ADDR A:0x1841008
y.create.l HWIO_GCC_USB_HS_PHY_CFG_AHB_CBCR_ADDR A:0x1841030
y.create.l HWIO_GCC_USB_HS_INACTIVITY_TIMERS_CBCR_ADDR A:0x184100c
y.create.l HWIO_GCC_USB_HS_SYSTEM_CMD_RCGR_ADDR A:0x1841010
y.create.l HWIO_GCC_USB_HS_SYSTEM_CFG_RCGR_ADDR A:0x1841014
y.create.l HWIO_GCC_USB2A_PHY_BCR_ADDR A:0x1841028
y.create.l HWIO_GCC_USB2_HS_PHY_ONLY_BCR_ADDR A:0x1841034
y.create.l HWIO_GCC_USB_HS_PHY_CFG_AHB_BCR_ADDR A:0x1841038
y.create.l HWIO_GCC_QUSB2_PHY_BCR_ADDR A:0x184103c
y.create.l HWIO_GCC_USB2A_PHY_SLEEP_CBCR_ADDR A:0x184102c
y.create.l HWIO_GCC_SDCC1_BCR_ADDR A:0x1842000
y.create.l HWIO_GCC_SDCC1_APPS_CMD_RCGR_ADDR A:0x1842004
y.create.l HWIO_GCC_SDCC1_APPS_CFG_RCGR_ADDR A:0x1842008
y.create.l HWIO_GCC_SDCC1_APPS_M_ADDR A:0x184200c
y.create.l HWIO_GCC_SDCC1_APPS_N_ADDR A:0x1842010
y.create.l HWIO_GCC_SDCC1_APPS_D_ADDR A:0x1842014
y.create.l HWIO_GCC_SDCC1_APPS_CBCR_ADDR A:0x1842018
y.create.l HWIO_GCC_SDCC1_AHB_CBCR_ADDR A:0x184201c
y.create.l HWIO_GCC_SDCC1_MISC_ADDR A:0x1842020
y.create.l HWIO_GCC_SDCC2_BCR_ADDR A:0x1843000
y.create.l HWIO_GCC_SDCC2_APPS_CMD_RCGR_ADDR A:0x1843004
y.create.l HWIO_GCC_SDCC2_APPS_CFG_RCGR_ADDR A:0x1843008
y.create.l HWIO_GCC_SDCC2_APPS_M_ADDR A:0x184300c
y.create.l HWIO_GCC_SDCC2_APPS_N_ADDR A:0x1843010
y.create.l HWIO_GCC_SDCC2_APPS_D_ADDR A:0x1843014
y.create.l HWIO_GCC_SDCC2_APPS_CBCR_ADDR A:0x1843018
y.create.l HWIO_GCC_SDCC2_AHB_CBCR_ADDR A:0x184301c
y.create.l HWIO_GCC_BLSP1_BCR_ADDR A:0x1801000
y.create.l HWIO_GCC_BLSP1_SLEEP_CBCR_ADDR A:0x1801004
y.create.l HWIO_GCC_BLSP1_AHB_CBCR_ADDR A:0x1801008
y.create.l HWIO_GCC_BLSP1_QUP1_BCR_ADDR A:0x1802000
y.create.l HWIO_GCC_BLSP1_QUP1_SPI_APPS_CBCR_ADDR A:0x1802004
y.create.l HWIO_GCC_BLSP1_QUP1_I2C_APPS_CBCR_ADDR A:0x1802008
y.create.l HWIO_GCC_BLSP1_QUP1_I2C_APPS_CMD_RCGR_ADDR A:0x180200c
y.create.l HWIO_GCC_BLSP1_QUP1_I2C_APPS_CFG_RCGR_ADDR A:0x1802010
y.create.l HWIO_GCC_BLSP1_QUP2_I2C_APPS_CMD_RCGR_ADDR A:0x1803000
y.create.l HWIO_GCC_BLSP1_QUP2_I2C_APPS_CFG_RCGR_ADDR A:0x1803004
y.create.l HWIO_GCC_BLSP1_QUP3_I2C_APPS_CMD_RCGR_ADDR A:0x1804000
y.create.l HWIO_GCC_BLSP1_QUP3_I2C_APPS_CFG_RCGR_ADDR A:0x1804004
y.create.l HWIO_GCC_BLSP1_QUP4_I2C_APPS_CMD_RCGR_ADDR A:0x1805000
y.create.l HWIO_GCC_BLSP1_QUP4_I2C_APPS_CFG_RCGR_ADDR A:0x1805004
y.create.l HWIO_GCC_BLSP1_QUP5_I2C_APPS_CMD_RCGR_ADDR A:0x1806000
y.create.l HWIO_GCC_BLSP1_QUP5_I2C_APPS_CFG_RCGR_ADDR A:0x1806004
y.create.l HWIO_GCC_BLSP1_QUP6_I2C_APPS_CMD_RCGR_ADDR A:0x1807000
y.create.l HWIO_GCC_BLSP1_QUP6_I2C_APPS_CFG_RCGR_ADDR A:0x1807004
y.create.l HWIO_GCC_BLSP1_QUP1_SPI_APPS_CMD_RCGR_ADDR A:0x1802024
y.create.l HWIO_GCC_BLSP1_QUP1_SPI_APPS_CFG_RCGR_ADDR A:0x1802028
y.create.l HWIO_GCC_BLSP1_QUP1_SPI_APPS_M_ADDR A:0x180202c
y.create.l HWIO_GCC_BLSP1_QUP1_SPI_APPS_N_ADDR A:0x1802030
y.create.l HWIO_GCC_BLSP1_QUP1_SPI_APPS_D_ADDR A:0x1802034
y.create.l HWIO_GCC_BLSP1_UART1_BCR_ADDR A:0x1802038
y.create.l HWIO_GCC_BLSP1_UART1_APPS_CBCR_ADDR A:0x180203c
y.create.l HWIO_GCC_BLSP1_UART1_SIM_CBCR_ADDR A:0x1802040
y.create.l HWIO_GCC_BLSP1_UART1_APPS_CMD_RCGR_ADDR A:0x1802044
y.create.l HWIO_GCC_BLSP1_UART1_APPS_CFG_RCGR_ADDR A:0x1802048
y.create.l HWIO_GCC_BLSP1_UART1_APPS_M_ADDR A:0x180204c
y.create.l HWIO_GCC_BLSP1_UART1_APPS_N_ADDR A:0x1802050
y.create.l HWIO_GCC_BLSP1_UART1_APPS_D_ADDR A:0x1802054
y.create.l HWIO_GCC_BLSP1_QUP2_BCR_ADDR A:0x1803008
y.create.l HWIO_GCC_BLSP1_QUP2_SPI_APPS_CBCR_ADDR A:0x180300c
y.create.l HWIO_GCC_BLSP1_QUP2_I2C_APPS_CBCR_ADDR A:0x1803010
y.create.l HWIO_GCC_BLSP1_QUP2_SPI_APPS_CMD_RCGR_ADDR A:0x1803014
y.create.l HWIO_GCC_BLSP1_QUP2_SPI_APPS_CFG_RCGR_ADDR A:0x1803018
y.create.l HWIO_GCC_BLSP1_QUP2_SPI_APPS_M_ADDR A:0x180301c
y.create.l HWIO_GCC_BLSP1_QUP2_SPI_APPS_N_ADDR A:0x1803020
y.create.l HWIO_GCC_BLSP1_QUP2_SPI_APPS_D_ADDR A:0x1803024
y.create.l HWIO_GCC_BLSP1_UART2_BCR_ADDR A:0x1803028
y.create.l HWIO_GCC_BLSP1_UART2_APPS_CBCR_ADDR A:0x180302c
y.create.l HWIO_GCC_BLSP1_UART2_SIM_CBCR_ADDR A:0x1803030
y.create.l HWIO_GCC_BLSP1_UART2_APPS_CMD_RCGR_ADDR A:0x1803034
y.create.l HWIO_GCC_BLSP1_UART2_APPS_CFG_RCGR_ADDR A:0x1803038
y.create.l HWIO_GCC_BLSP1_UART2_APPS_M_ADDR A:0x180303c
y.create.l HWIO_GCC_BLSP1_UART2_APPS_N_ADDR A:0x1803040
y.create.l HWIO_GCC_BLSP1_UART2_APPS_D_ADDR A:0x1803044
y.create.l HWIO_GCC_BLSP1_QUP3_BCR_ADDR A:0x1804018
y.create.l HWIO_GCC_BLSP1_QUP3_SPI_APPS_CBCR_ADDR A:0x180401c
y.create.l HWIO_GCC_BLSP1_QUP3_I2C_APPS_CBCR_ADDR A:0x1804020
y.create.l HWIO_GCC_BLSP1_QUP3_SPI_APPS_CMD_RCGR_ADDR A:0x1804024
y.create.l HWIO_GCC_BLSP1_QUP3_SPI_APPS_CFG_RCGR_ADDR A:0x1804028
y.create.l HWIO_GCC_BLSP1_QUP3_SPI_APPS_M_ADDR A:0x180402c
y.create.l HWIO_GCC_BLSP1_QUP3_SPI_APPS_N_ADDR A:0x1804030
y.create.l HWIO_GCC_BLSP1_QUP3_SPI_APPS_D_ADDR A:0x1804034
y.create.l HWIO_GCC_BLSP1_QUP4_BCR_ADDR A:0x1805018
y.create.l HWIO_GCC_BLSP1_QUP4_SPI_APPS_CBCR_ADDR A:0x180501c
y.create.l HWIO_GCC_BLSP1_QUP4_I2C_APPS_CBCR_ADDR A:0x1805020
y.create.l HWIO_GCC_BLSP1_QUP4_SPI_APPS_CMD_RCGR_ADDR A:0x1805024
y.create.l HWIO_GCC_BLSP1_QUP4_SPI_APPS_CFG_RCGR_ADDR A:0x1805028
y.create.l HWIO_GCC_BLSP1_QUP4_SPI_APPS_M_ADDR A:0x180502c
y.create.l HWIO_GCC_BLSP1_QUP4_SPI_APPS_N_ADDR A:0x1805030
y.create.l HWIO_GCC_BLSP1_QUP4_SPI_APPS_D_ADDR A:0x1805034
y.create.l HWIO_GCC_BLSP1_QUP5_BCR_ADDR A:0x1806018
y.create.l HWIO_GCC_BLSP1_QUP5_SPI_APPS_CBCR_ADDR A:0x180601c
y.create.l HWIO_GCC_BLSP1_QUP5_I2C_APPS_CBCR_ADDR A:0x1806020
y.create.l HWIO_GCC_BLSP1_QUP5_SPI_APPS_CMD_RCGR_ADDR A:0x1806024
y.create.l HWIO_GCC_BLSP1_QUP5_SPI_APPS_CFG_RCGR_ADDR A:0x1806028
y.create.l HWIO_GCC_BLSP1_QUP5_SPI_APPS_M_ADDR A:0x180602c
y.create.l HWIO_GCC_BLSP1_QUP5_SPI_APPS_N_ADDR A:0x1806030
y.create.l HWIO_GCC_BLSP1_QUP5_SPI_APPS_D_ADDR A:0x1806034
y.create.l HWIO_GCC_BLSP1_QUP6_BCR_ADDR A:0x1807018
y.create.l HWIO_GCC_BLSP1_QUP6_SPI_APPS_CBCR_ADDR A:0x180701c
y.create.l HWIO_GCC_BLSP1_QUP6_I2C_APPS_CBCR_ADDR A:0x1807020
y.create.l HWIO_GCC_BLSP1_QUP6_SPI_APPS_CMD_RCGR_ADDR A:0x1807024
y.create.l HWIO_GCC_BLSP1_QUP6_SPI_APPS_CFG_RCGR_ADDR A:0x1807028
y.create.l HWIO_GCC_BLSP1_QUP6_SPI_APPS_M_ADDR A:0x180702c
y.create.l HWIO_GCC_BLSP1_QUP6_SPI_APPS_N_ADDR A:0x1807030
y.create.l HWIO_GCC_BLSP1_QUP6_SPI_APPS_D_ADDR A:0x1807034
y.create.l HWIO_GCC_BLSP_UART_SIM_CMD_RCGR_ADDR A:0x180100c
y.create.l HWIO_GCC_BLSP_UART_SIM_CFG_RCGR_ADDR A:0x1801010
y.create.l HWIO_GCC_PRNG_XPU_CFG_AHB_CBCR_ADDR A:0x1817008
y.create.l HWIO_GCC_PDM_BCR_ADDR A:0x1844000
y.create.l HWIO_GCC_PDM_AHB_CBCR_ADDR A:0x1844004
y.create.l HWIO_GCC_PDM_XO4_CBCR_ADDR A:0x1844008
y.create.l HWIO_GCC_PDM2_CBCR_ADDR A:0x184400c
y.create.l HWIO_GCC_PDM2_CMD_RCGR_ADDR A:0x1844010
y.create.l HWIO_GCC_PDM2_CFG_RCGR_ADDR A:0x1844014
y.create.l HWIO_GCC_PRNG_BCR_ADDR A:0x1813000
y.create.l HWIO_GCC_PRNG_AHB_CBCR_ADDR A:0x1813004
y.create.l HWIO_GCC_TCSR_BCR_ADDR A:0x1828000
y.create.l HWIO_GCC_TCSR_AHB_CBCR_ADDR A:0x1828004
y.create.l HWIO_GCC_BOOT_ROM_BCR_ADDR A:0x1813008
y.create.l HWIO_GCC_BOOT_ROM_AHB_CBCR_ADDR A:0x181300c
y.create.l HWIO_GCC_MSG_RAM_BCR_ADDR A:0x182b000
y.create.l HWIO_GCC_MSG_RAM_AHB_CBCR_ADDR A:0x182b004
y.create.l HWIO_GCC_TLMM_BCR_ADDR A:0x1834000
y.create.l HWIO_GCC_TLMM_AHB_CBCR_ADDR A:0x1834004
y.create.l HWIO_GCC_TLMM_CBCR_ADDR A:0x1834008
y.create.l HWIO_GCC_MPM_BCR_ADDR A:0x182c000
y.create.l HWIO_GCC_MPM_MISC_ADDR A:0x182c004
y.create.l HWIO_GCC_MPM_AHB_CBCR_ADDR A:0x182c008
y.create.l HWIO_GCC_RPM_PROC_HCLK_CBCR_ADDR A:0x182d000
y.create.l HWIO_GCC_RPM_BUS_AHB_CBCR_ADDR A:0x182d004
y.create.l HWIO_GCC_RPM_SLEEP_CBCR_ADDR A:0x182d008
y.create.l HWIO_GCC_RPM_TIMER_CBCR_ADDR A:0x182d00c
y.create.l HWIO_GCC_RPM_CMD_RCGR_ADDR A:0x182d010
y.create.l HWIO_GCC_RPM_CFG_RCGR_ADDR A:0x182d014
y.create.l HWIO_GCC_RPM_MISC_ADDR A:0x182d028
y.create.l HWIO_GCC_SEC_CTRL_BCR_ADDR A:0x181a000
y.create.l HWIO_GCC_ACC_CMD_RCGR_ADDR A:0x181a004
y.create.l HWIO_GCC_ACC_CFG_RCGR_ADDR A:0x181a008
y.create.l HWIO_GCC_ACC_MISC_ADDR A:0x181a01c
y.create.l HWIO_GCC_SEC_CTRL_ACC_CBCR_ADDR A:0x181a020
y.create.l HWIO_GCC_SEC_CTRL_AHB_CBCR_ADDR A:0x181a024
y.create.l HWIO_GCC_SEC_CTRL_CBCR_ADDR A:0x181a028
y.create.l HWIO_GCC_SEC_CTRL_SENSE_CBCR_ADDR A:0x181a02c
y.create.l HWIO_GCC_SEC_CTRL_BOOT_ROM_PATCH_CBCR_ADDR A:0x181a030
y.create.l HWIO_GCC_SEC_CTRL_CMD_RCGR_ADDR A:0x181a034
y.create.l HWIO_GCC_SEC_CTRL_CFG_RCGR_ADDR A:0x181a038
y.create.l HWIO_GCC_SPMI_BCR_ADDR A:0x182e000
y.create.l HWIO_GCC_SPMI_SER_CMD_RCGR_ADDR A:0x182e004
y.create.l HWIO_GCC_SPMI_SER_CFG_RCGR_ADDR A:0x182e008
y.create.l HWIO_GCC_SPMI_SER_CBCR_ADDR A:0x182e01c
y.create.l HWIO_GCC_SPMI_PCNOC_AHB_CBCR_ADDR A:0x182e020
y.create.l HWIO_GCC_SPMI_AHB_CMD_RCGR_ADDR A:0x182e024
y.create.l HWIO_GCC_SPMI_AHB_CFG_RCGR_ADDR A:0x182e028
y.create.l HWIO_GCC_SPMI_AHB_CBCR_ADDR A:0x182e03c
y.create.l HWIO_GCC_SPDM_BCR_ADDR A:0x182f000
y.create.l HWIO_GCC_SPDM_CFG_AHB_CBCR_ADDR A:0x182f004
y.create.l HWIO_GCC_SPDM_MSTR_AHB_CBCR_ADDR A:0x182f008
y.create.l HWIO_GCC_SPDM_FF_CBCR_ADDR A:0x182f00c
y.create.l HWIO_GCC_SPDM_BIMC_CY_CBCR_ADDR A:0x182f010
y.create.l HWIO_GCC_SPDM_SNOC_CY_CBCR_ADDR A:0x182f014
y.create.l HWIO_GCC_SPDM_DEBUG_CY_CBCR_ADDR A:0x182f018
y.create.l HWIO_GCC_SPDM_PCNOC_CY_CBCR_ADDR A:0x182f01c
y.create.l HWIO_GCC_SPDM_RPM_CY_CBCR_ADDR A:0x182f020
y.create.l HWIO_GCC_CRYPTO_BCR_ADDR A:0x1816000
y.create.l HWIO_GCC_CRYPTO_CMD_RCGR_ADDR A:0x1816004
y.create.l HWIO_GCC_CRYPTO_CFG_RCGR_ADDR A:0x1816008
y.create.l HWIO_GCC_CRYPTO_CBCR_ADDR A:0x181601c
y.create.l HWIO_GCC_CRYPTO_AXI_CBCR_ADDR A:0x1816020
y.create.l HWIO_GCC_CRYPTO_AHB_CBCR_ADDR A:0x1816024
y.create.l HWIO_GCC_GCC_AHB_CBCR_ADDR A:0x1830014
y.create.l HWIO_GCC_GCC_XO_CMD_RCGR_ADDR A:0x1830018
y.create.l HWIO_GCC_GCC_XO_CBCR_ADDR A:0x1830030
y.create.l HWIO_GCC_GCC_XO_DIV4_CBCR_ADDR A:0x1830034
y.create.l HWIO_GCC_GCC_IM_SLEEP_CBCR_ADDR A:0x1830038
y.create.l HWIO_GCC_BIMC_BCR_ADDR A:0x1831000
y.create.l HWIO_GCC_BIMC_GDSCR_ADDR A:0x1831004
y.create.l HWIO_GCC_BIMC_DDR_XO_CMD_RCGR_ADDR A:0x1832000
y.create.l HWIO_GCC_BIMC_XO_CBCR_ADDR A:0x1831008
y.create.l HWIO_GCC_BIMC_CFG_AHB_CBCR_ADDR A:0x183100c
y.create.l HWIO_GCC_BIMC_SLEEP_CBCR_ADDR A:0x1831010
y.create.l HWIO_GCC_BIMC_SYSNOC_AXI_CBCR_ADDR A:0x1831014
y.create.l HWIO_GCC_BIMC_DDR_CMD_RCGR_ADDR A:0x1832004
y.create.l HWIO_GCC_BIMC_DDR_CFG_RCGR_ADDR A:0x1832008
y.create.l HWIO_GCC_BIMC_MISC_ADDR A:0x1831018
y.create.l HWIO_GCC_BIMC_CBCR_ADDR A:0x183101c
y.create.l HWIO_GCC_BIMC_APSS_AXI_CBCR_ADDR A:0x1831020
y.create.l HWIO_GCC_DDR_DIM_CFG_CBCR_ADDR A:0x183201c
y.create.l HWIO_GCC_DDR_DIM_SLEEP_CBCR_ADDR A:0x1832020
y.create.l HWIO_GCC_APSS_TCU_CMD_RCGR_ADDR A:0x1837000
y.create.l HWIO_GCC_APSS_TCU_CFG_RCGR_ADDR A:0x1837004
y.create.l HWIO_GCC_BIMC_GPU_CMD_RCGR_ADDR A:0x1831028
y.create.l HWIO_GCC_BIMC_GPU_CFG_RCGR_ADDR A:0x183102c
y.create.l HWIO_GCC_BIMC_GPU_CBCR_ADDR A:0x1831040
y.create.l HWIO_GCC_BIMC_TCU_CBCR_ADDR A:0x1831044
y.create.l HWIO_GCC_ULTAUDIO_PCNOC_MPORT_CBCR_ADDR A:0x181c000
y.create.l HWIO_GCC_ULTAUDIO_PCNOC_SWAY_CBCR_ADDR A:0x181c004
y.create.l HWIO_GCC_ULT_AUDIO_BCR_ADDR A:0x181c0b4
y.create.l HWIO_GCC_APSS_AHB_CMD_RCGR_ADDR A:0x1846000
y.create.l HWIO_GCC_APSS_AHB_CFG_RCGR_ADDR A:0x1846004
y.create.l HWIO_GCC_APSS_AHB_MISC_ADDR A:0x1846018
y.create.l HWIO_GCC_APSS_AHB_CBCR_ADDR A:0x184601c
y.create.l HWIO_GCC_APSS_AXI_CBCR_ADDR A:0x1846020
y.create.l HWIO_GCC_SNOC_BUS_TIMEOUT0_BCR_ADDR A:0x1847000
y.create.l HWIO_GCC_SNOC_BUS_TIMEOUT0_AHB_CBCR_ADDR A:0x1847004
y.create.l HWIO_GCC_PCNOC_BUS_TIMEOUT0_BCR_ADDR A:0x1848000
y.create.l HWIO_GCC_PCNOC_BUS_TIMEOUT0_AHB_CBCR_ADDR A:0x1848004
y.create.l HWIO_GCC_PCNOC_BUS_TIMEOUT1_BCR_ADDR A:0x1848008
y.create.l HWIO_GCC_PCNOC_BUS_TIMEOUT1_AHB_CBCR_ADDR A:0x184800c
y.create.l HWIO_GCC_PCNOC_BUS_TIMEOUT2_BCR_ADDR A:0x1848010
y.create.l HWIO_GCC_PCNOC_BUS_TIMEOUT2_AHB_CBCR_ADDR A:0x1848014
y.create.l HWIO_GCC_PCNOC_BUS_TIMEOUT3_BCR_ADDR A:0x1848018
y.create.l HWIO_GCC_PCNOC_BUS_TIMEOUT3_AHB_CBCR_ADDR A:0x184801c
y.create.l HWIO_GCC_PCNOC_BUS_TIMEOUT4_BCR_ADDR A:0x1848020
y.create.l HWIO_GCC_PCNOC_BUS_TIMEOUT4_AHB_CBCR_ADDR A:0x1848024
y.create.l HWIO_GCC_PCNOC_BUS_TIMEOUT5_BCR_ADDR A:0x1848028
y.create.l HWIO_GCC_PCNOC_BUS_TIMEOUT5_AHB_CBCR_ADDR A:0x184802c
y.create.l HWIO_GCC_PCNOC_BUS_TIMEOUT6_BCR_ADDR A:0x1848030
y.create.l HWIO_GCC_PCNOC_BUS_TIMEOUT6_AHB_CBCR_ADDR A:0x1848034
y.create.l HWIO_GCC_PCNOC_BUS_TIMEOUT7_BCR_ADDR A:0x1848038
y.create.l HWIO_GCC_PCNOC_BUS_TIMEOUT7_AHB_CBCR_ADDR A:0x184803c
y.create.l HWIO_GCC_PCNOC_BUS_TIMEOUT8_BCR_ADDR A:0x1848040
y.create.l HWIO_GCC_PCNOC_BUS_TIMEOUT8_AHB_CBCR_ADDR A:0x1848044
y.create.l HWIO_GCC_PCNOC_BUS_TIMEOUT9_BCR_ADDR A:0x1848048
y.create.l HWIO_GCC_PCNOC_BUS_TIMEOUT9_AHB_CBCR_ADDR A:0x184804c
y.create.l HWIO_GCC_DEHR_BCR_ADDR A:0x181f000
y.create.l HWIO_GCC_DEHR_CBCR_ADDR A:0x181f004
y.create.l HWIO_GCC_PCNOC_MPU_CFG_AHB_CBCR_ADDR A:0x181700c
y.create.l HWIO_GCC_GFX_TBU_CBCR_ADDR A:0x1812010
y.create.l HWIO_GCC_VENUS_TBU_CBCR_ADDR A:0x1812014
y.create.l HWIO_GCC_APSS_TCU_ASYNC_CBCR_ADDR A:0x1812098
y.create.l HWIO_GCC_APSS_TCU_CBCR_ADDR A:0x1812018
y.create.l HWIO_GCC_MDP_TBU_CBCR_ADDR A:0x181201c
y.create.l HWIO_GCC_GFX_TCU_CBCR_ADDR A:0x1812020
y.create.l HWIO_GCC_MSS_TBU_AXI_CBCR_ADDR A:0x1812024
y.create.l HWIO_GCC_MSS_TBU_GSS_AXI_CBCR_ADDR A:0x1812028
y.create.l HWIO_GCC_MSS_TBU_Q6_AXI_CBCR_ADDR A:0x181202c
y.create.l HWIO_GCC_PCNOC_TBU_CBCR_ADDR A:0x1812030
y.create.l HWIO_GCC_PRONTO_TBU_CBCR_ADDR A:0x1812048
y.create.l HWIO_GCC_SMMU_CFG_CBCR_ADDR A:0x1812038
y.create.l HWIO_GCC_VFE_TBU_CBCR_ADDR A:0x181203c
y.create.l HWIO_GCC_SMMU_XPU_CBCR_ADDR A:0x1817010
y.create.l HWIO_GCC_GTCU_AHB_CBCR_ADDR A:0x1812044
y.create.l HWIO_GCC_SMMU_CATS_CBCR_ADDR A:0x187c004
y.create.l HWIO_GCC_SMMU_CATS_BCR_ADDR A:0x187c000
y.create.l HWIO_GCC_SMMU_BCR_ADDR A:0x1812000
y.create.l HWIO_GCC_APSS_TCU_BCR_ADDR A:0x1812050
y.create.l HWIO_GCC_MDP_TBU_BCR_ADDR A:0x1862000
y.create.l HWIO_GCC_GFX_TBU_BCR_ADDR A:0x1863000
y.create.l HWIO_GCC_GFX_TCU_BCR_ADDR A:0x1864000
y.create.l HWIO_GCC_MSS_TBU_AXI_BCR_ADDR A:0x1865000
y.create.l HWIO_GCC_MSS_TBU_Q6_AXI_BCR_ADDR A:0x1867000
y.create.l HWIO_GCC_MSS_TBU_GSS_AXI_BCR_ADDR A:0x1866000
y.create.l HWIO_GCC_GTCU_AHB_BCR_ADDR A:0x1868000
y.create.l HWIO_GCC_SMMU_XPU_BCR_ADDR A:0x1812054
y.create.l HWIO_GCC_SMMU_CFG_BCR_ADDR A:0x181208c
y.create.l HWIO_GCC_VFE_TBU_BCR_ADDR A:0x186a000
y.create.l HWIO_GCC_VENUS_TBU_BCR_ADDR A:0x186b000
y.create.l HWIO_GCC_PRONTO_TBU_BCR_ADDR A:0x186d000
y.create.l HWIO_GCC_PCNOC_TBU_BCR_ADDR A:0x1812058
y.create.l HWIO_GCC_RBCPR_BCR_ADDR A:0x1833000
y.create.l HWIO_GCC_RBCPR_CBCR_ADDR A:0x1833004
y.create.l HWIO_GCC_RBCPR_AHB_CBCR_ADDR A:0x1833008
y.create.l HWIO_GCC_RBCPR_CMD_RCGR_ADDR A:0x183300c
y.create.l HWIO_GCC_RBCPR_CFG_RCGR_ADDR A:0x1833010
y.create.l HWIO_GCC_RPM_GPLL_ENA_VOTE_ADDR A:0x1836000
y.create.l HWIO_GCC_RPM_CLOCK_BRANCH_ENA_VOTE_ADDR A:0x1836004
y.create.l HWIO_GCC_RPM_SMMU_CLOCK_BRANCH_ENA_VOTE_ADDR A:0x183600c
y.create.l HWIO_GCC_RPM_CLOCK_SLEEP_ENA_VOTE_ADDR A:0x1836008
y.create.l HWIO_GCC_RPM_SMMU_CLOCK_SLEEP_ENA_VOTE_ADDR A:0x1836010
y.create.l HWIO_GCC_APCS_GPLL_ENA_VOTE_ADDR A:0x1845000
y.create.l HWIO_GCC_APCS_CLOCK_BRANCH_ENA_VOTE_ADDR A:0x1845004
y.create.l HWIO_GCC_APCS_SMMU_CLOCK_BRANCH_ENA_VOTE_ADDR A:0x184500c
y.create.l HWIO_GCC_APCS_CLOCK_SLEEP_ENA_VOTE_ADDR A:0x1845008
y.create.l HWIO_GCC_APCS_SMMU_CLOCK_SLEEP_ENA_VOTE_ADDR A:0x1845010
y.create.l HWIO_GCC_APCS_TZ_GPLL_ENA_VOTE_ADDR A:0x1813010
y.create.l HWIO_GCC_APCS_TZ_CLOCK_BRANCH_ENA_VOTE_ADDR A:0x1813014
y.create.l HWIO_GCC_APCS_TZ_SMMU_CLOCK_BRANCH_ENA_VOTE_ADDR A:0x1813020
y.create.l HWIO_GCC_APCS_TZ_CLOCK_SLEEP_ENA_VOTE_ADDR A:0x1813018
y.create.l HWIO_GCC_APCS_TZ_SMMU_CLOCK_SLEEP_ENA_VOTE_ADDR A:0x1813024
y.create.l HWIO_GCC_APCS_HYP_GPLL_ENA_VOTE_ADDR A:0x1861000
y.create.l HWIO_GCC_APCS_HYP_CLOCK_BRANCH_ENA_VOTE_ADDR A:0x1861004
y.create.l HWIO_GCC_APCS_HYP_SMMU_CLOCK_BRANCH_ENA_VOTE_ADDR A:0x186100c
y.create.l HWIO_GCC_APCS_HYP_CLOCK_SLEEP_ENA_VOTE_ADDR A:0x1861008
y.create.l HWIO_GCC_APCS_HYP_SMMU_CLOCK_SLEEP_ENA_VOTE_ADDR A:0x1861010
y.create.l HWIO_GCC_MSS_Q6_GPLL_ENA_VOTE_ADDR A:0x181b000
y.create.l HWIO_GCC_MSS_Q6_CLOCK_BRANCH_ENA_VOTE_ADDR A:0x181b004
y.create.l HWIO_GCC_MSS_Q6_CLOCK_SLEEP_ENA_VOTE_ADDR A:0x181b008
y.create.l HWIO_GCC_WCSS_GPLL_ENA_VOTE_ADDR A:0x1870000
y.create.l HWIO_GCC_WCSS_CLOCK_BRANCH_ENA_VOTE_ADDR A:0x1870004
y.create.l HWIO_GCC_WCSS_CLOCK_SLEEP_ENA_VOTE_ADDR A:0x1870008
y.create.l HWIO_GCC_SPARE_GPLL_ENA_VOTE_ADDR A:0x1800000
y.create.l HWIO_GCC_SPARE_CLOCK_BRANCH_ENA_VOTE_ADDR A:0x1800004
y.create.l HWIO_GCC_MSS_RESTART_ADDR A:0x183e000
y.create.l HWIO_GCC_VENUS_RESTART_ADDR A:0x1810004
y.create.l HWIO_GCC_WCSS_RESTART_ADDR A:0x1811000
y.create.l HWIO_GCC_RESET_DEBUG_ADDR A:0x1814000
y.create.l HWIO_GCC_FLUSH_ETR_DEBUG_TIMER_ADDR A:0x1815000
y.create.l HWIO_GCC_STOP_CAPTURE_DEBUG_TIMER_ADDR A:0x1815004
y.create.l HWIO_GCC_RESET_STATUS_ADDR A:0x1815008
y.create.l HWIO_GCC_SW_SRST_ADDR A:0x181500c
y.create.l HWIO_GCC_PROC_HALT_ADDR A:0x181301c
y.create.l HWIO_GCC_GCC_DEBUG_CLK_CTL_ADDR A:0x1874000
y.create.l HWIO_GCC_CLOCK_FRQ_MEASURE_CTL_ADDR A:0x1874004
y.create.l HWIO_GCC_CLOCK_FRQ_MEASURE_STATUS_ADDR A:0x1874008
y.create.l HWIO_GCC_PLLTEST_PAD_CFG_ADDR A:0x187400c
y.create.l HWIO_GCC_JITTER_PROBE_CFG_ADDR A:0x1874010
y.create.l HWIO_GCC_JITTER_PROBE_VAL_ADDR A:0x1874014
y.create.l HWIO_GCC_GP1_CBCR_ADDR A:0x1808000
y.create.l HWIO_GCC_GP1_CMD_RCGR_ADDR A:0x1808004
y.create.l HWIO_GCC_GP1_CFG_RCGR_ADDR A:0x1808008
y.create.l HWIO_GCC_GP1_M_ADDR A:0x180800c
y.create.l HWIO_GCC_GP1_N_ADDR A:0x1808010
y.create.l HWIO_GCC_GP1_D_ADDR A:0x1808014
y.create.l HWIO_GCC_GP2_CBCR_ADDR A:0x1809000
y.create.l HWIO_GCC_GP2_CMD_RCGR_ADDR A:0x1809004
y.create.l HWIO_GCC_GP2_CFG_RCGR_ADDR A:0x1809008
y.create.l HWIO_GCC_GP2_M_ADDR A:0x180900c
y.create.l HWIO_GCC_GP2_N_ADDR A:0x1809010
y.create.l HWIO_GCC_GP2_D_ADDR A:0x1809014
y.create.l HWIO_GCC_GP3_CBCR_ADDR A:0x180a000
y.create.l HWIO_GCC_GP3_CMD_RCGR_ADDR A:0x180a004
y.create.l HWIO_GCC_GP3_CFG_RCGR_ADDR A:0x180a008
y.create.l HWIO_GCC_GP3_M_ADDR A:0x180a00c
y.create.l HWIO_GCC_GP3_N_ADDR A:0x180a010
y.create.l HWIO_GCC_GP3_D_ADDR A:0x180a014
y.create.l HWIO_GCC_APSS_MISC_ADDR A:0x1860000
y.create.l HWIO_GCC_TIC_MODE_APSS_BOOT_ADDR A:0x187f000
y.create.l HWIO_GCC_USB_BOOT_CLOCK_CTL_ADDR A:0x1840000
y.create.l HWIO_GCC_RAW_SLEEP_CLK_CTRL_ADDR A:0x1835000
y.create.l HWIO_GCC_S1LM_MODEM_DIV_VOTE_ADDR A:0x1800008
y.create.l HWIO_GCC_GCC_SPARE1_REG_ADDR A:0x180000c
y.create.l HWIO_GCC_S1LM_APPS_DIV_VOTE_ADDR A:0x187e000
y.create.l HWIO_GCC_GCC_SPARE3_REG_ADDR A:0x187e004
y.create.l HWIO_GCC_DCD_BCR_ADDR A:0x182a000
y.create.l HWIO_GCC_DCD_XO_CBCR_ADDR A:0x182a004
y.create.l HWIO_GCC_SNOC_DCD_CONFIG_ADDR A:0x182a008
y.create.l HWIO_GCC_SNOC_DCD_HYSTERESIS_CNT_ADDR A:0x182a00c
y.create.l HWIO_GCC_PCNOC_DCD_CONFIG_ADDR A:0x182a010
y.create.l HWIO_GCC_PCNOC_DCD_HYSTERESIS_CNT_ADDR A:0x182a014
y.create.l HWIO_GCC_MM_SPDM_BCR_ADDR A:0x182f024
y.create.l HWIO_GCC_SPDM_MDP_CBCR_ADDR A:0x182f02c
y.create.l HWIO_GCC_SPDM_VCODEC0_CBCR_ADDR A:0x182f034
y.create.l HWIO_GCC_SPDM_VFE0_CBCR_ADDR A:0x182f038
y.create.l HWIO_GCC_SPDM_GFX3D_CBCR_ADDR A:0x182f03c
y.create.l HWIO_GCC_SPDM_AHB_CBCR_ADDR A:0x182f040
y.create.l HWIO_GCC_SPDM_PCLK0_CBCR_ADDR A:0x182f044
y.create.l HWIO_GCC_SPDM_CSI0_CBCR_ADDR A:0x182f048
y.create.l HWIO_GCC_VCODEC0_CMD_RCGR_ADDR A:0x184c000
y.create.l HWIO_GCC_VCODEC0_CFG_RCGR_ADDR A:0x184c004
y.create.l HWIO_GCC_VCODEC0_M_ADDR A:0x184c008
y.create.l HWIO_GCC_VCODEC0_N_ADDR A:0x184c00c
y.create.l HWIO_GCC_VCODEC0_D_ADDR A:0x184c010
y.create.l HWIO_GCC_VENUS0_BCR_ADDR A:0x184c014
y.create.l HWIO_GCC_VENUS0_GDSCR_ADDR A:0x184c018
y.create.l HWIO_GCC_VENUS0_CORE0_GDSCR_ADDR A:0x184c028
y.create.l HWIO_GCC_VENUS0_VCODEC0_CBCR_ADDR A:0x184c01c
y.create.l HWIO_GCC_VENUS0_CORE0_VCODEC0_CBCR_ADDR A:0x184c02c
y.create.l HWIO_GCC_VENUS0_AHB_CBCR_ADDR A:0x184c020
y.create.l HWIO_GCC_VENUS0_AXI_CBCR_ADDR A:0x184c024
y.create.l HWIO_GCC_PCLK0_CMD_RCGR_ADDR A:0x184d000
y.create.l HWIO_GCC_PCLK0_CFG_RCGR_ADDR A:0x184d004
y.create.l HWIO_GCC_PCLK0_M_ADDR A:0x184d008
y.create.l HWIO_GCC_PCLK0_N_ADDR A:0x184d00c
y.create.l HWIO_GCC_PCLK0_D_ADDR A:0x184d010
y.create.l HWIO_GCC_MDP_CMD_RCGR_ADDR A:0x184d014
y.create.l HWIO_GCC_MDP_CFG_RCGR_ADDR A:0x184d018
y.create.l HWIO_GCC_VSYNC_CMD_RCGR_ADDR A:0x184d02c
y.create.l HWIO_GCC_VSYNC_CFG_RCGR_ADDR A:0x184d030
y.create.l HWIO_GCC_BYTE0_CMD_RCGR_ADDR A:0x184d044
y.create.l HWIO_GCC_BYTE0_CFG_RCGR_ADDR A:0x184d048
y.create.l HWIO_GCC_ESC0_CMD_RCGR_ADDR A:0x184d05c
y.create.l HWIO_GCC_ESC0_CFG_RCGR_ADDR A:0x184d060
y.create.l HWIO_GCC_MDSS_BCR_ADDR A:0x184d074
y.create.l HWIO_GCC_MDSS_GDSCR_ADDR A:0x184d078
y.create.l HWIO_GCC_MDSS_AHB_CBCR_ADDR A:0x184d07c
y.create.l HWIO_GCC_MDSS_AXI_CBCR_ADDR A:0x184d080
y.create.l HWIO_GCC_MDSS_PCLK0_CBCR_ADDR A:0x184d084
y.create.l HWIO_GCC_MDSS_MDP_CBCR_ADDR A:0x184d088
y.create.l HWIO_GCC_MDSS_VSYNC_CBCR_ADDR A:0x184d090
y.create.l HWIO_GCC_MDSS_BYTE0_CBCR_ADDR A:0x184d094
y.create.l HWIO_GCC_MDSS_ESC0_CBCR_ADDR A:0x184d098
y.create.l HWIO_GCC_CSI0PHYTIMER_CMD_RCGR_ADDR A:0x184e000
y.create.l HWIO_GCC_CSI0PHYTIMER_CFG_RCGR_ADDR A:0x184e004
y.create.l HWIO_GCC_CAMSS_PHY0_BCR_ADDR A:0x184e018
y.create.l HWIO_GCC_CAMSS_PHY0_CSI0PHYTIMER_CBCR_ADDR A:0x184e01c
y.create.l HWIO_GCC_CSI0_CMD_RCGR_ADDR A:0x184e020
y.create.l HWIO_GCC_CSI0_CFG_RCGR_ADDR A:0x184e024
y.create.l HWIO_GCC_CAMSS_CSI0_BCR_ADDR A:0x184e038
y.create.l HWIO_GCC_CAMSS_CSI0_CBCR_ADDR A:0x184e03c
y.create.l HWIO_GCC_CAMSS_CSI0_AHB_CBCR_ADDR A:0x184e040
y.create.l HWIO_GCC_CAMSS_CSI0PHY_BCR_ADDR A:0x184e044
y.create.l HWIO_GCC_CAMSS_CSI0PHY_CBCR_ADDR A:0x184e048
y.create.l HWIO_GCC_CAMSS_CSI0RDI_BCR_ADDR A:0x184e04c
y.create.l HWIO_GCC_CAMSS_CSI0RDI_CBCR_ADDR A:0x184e050
y.create.l HWIO_GCC_CAMSS_CSI0PIX_BCR_ADDR A:0x184e054
y.create.l HWIO_GCC_CAMSS_CSI0PIX_CBCR_ADDR A:0x184e058
y.create.l HWIO_GCC_CSI1_CMD_RCGR_ADDR A:0x184f020
y.create.l HWIO_GCC_CSI1_CFG_RCGR_ADDR A:0x184f024
y.create.l HWIO_GCC_CAMSS_CSI1_BCR_ADDR A:0x184f038
y.create.l HWIO_GCC_CAMSS_CSI1_CBCR_ADDR A:0x184f03c
y.create.l HWIO_GCC_CAMSS_CSI1_AHB_CBCR_ADDR A:0x184f040
y.create.l HWIO_GCC_CAMSS_CSI1PHY_BCR_ADDR A:0x184f044
y.create.l HWIO_GCC_CAMSS_CSI1PHY_CBCR_ADDR A:0x184f048
y.create.l HWIO_GCC_CAMSS_CSI1RDI_BCR_ADDR A:0x184f04c
y.create.l HWIO_GCC_CAMSS_CSI1RDI_CBCR_ADDR A:0x184f050
y.create.l HWIO_GCC_CAMSS_CSI1PIX_BCR_ADDR A:0x184f054
y.create.l HWIO_GCC_CAMSS_CSI1PIX_CBCR_ADDR A:0x184f058
y.create.l HWIO_GCC_CAMSS_ISPIF_BCR_ADDR A:0x1850000
y.create.l HWIO_GCC_CAMSS_ISPIF_AHB_CBCR_ADDR A:0x1850004
y.create.l HWIO_GCC_MCLK0_CMD_RCGR_ADDR A:0x1852000
y.create.l HWIO_GCC_MCLK0_CFG_RCGR_ADDR A:0x1852004
y.create.l HWIO_GCC_MCLK0_M_ADDR A:0x1852008
y.create.l HWIO_GCC_MCLK0_N_ADDR A:0x185200c
y.create.l HWIO_GCC_MCLK0_D_ADDR A:0x1852010
y.create.l HWIO_GCC_CAMSS_MCLK0_BCR_ADDR A:0x1852014
y.create.l HWIO_GCC_CAMSS_MCLK0_CBCR_ADDR A:0x1852018
y.create.l HWIO_GCC_MCLK1_CMD_RCGR_ADDR A:0x1853000
y.create.l HWIO_GCC_MCLK1_CFG_RCGR_ADDR A:0x1853004
y.create.l HWIO_GCC_MCLK1_M_ADDR A:0x1853008
y.create.l HWIO_GCC_MCLK1_N_ADDR A:0x185300c
y.create.l HWIO_GCC_MCLK1_D_ADDR A:0x1853010
y.create.l HWIO_GCC_CAMSS_MCLK1_BCR_ADDR A:0x1853014
y.create.l HWIO_GCC_CAMSS_MCLK1_CBCR_ADDR A:0x1853018
y.create.l HWIO_GCC_MM_GP0_CMD_RCGR_ADDR A:0x1854000
y.create.l HWIO_GCC_MM_GP0_CFG_RCGR_ADDR A:0x1854004
y.create.l HWIO_GCC_MM_GP0_M_ADDR A:0x1854008
y.create.l HWIO_GCC_MM_GP0_N_ADDR A:0x185400c
y.create.l HWIO_GCC_MM_GP0_D_ADDR A:0x1854010
y.create.l HWIO_GCC_CAMSS_GP0_BCR_ADDR A:0x1854014
y.create.l HWIO_GCC_CAMSS_GP0_CBCR_ADDR A:0x1854018
y.create.l HWIO_GCC_MM_GP1_CMD_RCGR_ADDR A:0x1855000
y.create.l HWIO_GCC_MM_GP1_CFG_RCGR_ADDR A:0x1855004
y.create.l HWIO_GCC_MM_GP1_M_ADDR A:0x1855008
y.create.l HWIO_GCC_MM_GP1_N_ADDR A:0x185500c
y.create.l HWIO_GCC_MM_GP1_D_ADDR A:0x1855010
y.create.l HWIO_GCC_CAMSS_GP1_BCR_ADDR A:0x1855014
y.create.l HWIO_GCC_CAMSS_GP1_CBCR_ADDR A:0x1855018
y.create.l HWIO_GCC_CAMSS_TOP_BCR_ADDR A:0x1856000
y.create.l HWIO_GCC_CAMSS_TOP_AHB_CBCR_ADDR A:0x185a014
y.create.l HWIO_GCC_CAMSS_TOP_AHB_BCR_ADDR A:0x185a018
y.create.l HWIO_GCC_CAMSS_AHB_CBCR_ADDR A:0x1856004
y.create.l HWIO_GCC_VFE0_CMD_RCGR_ADDR A:0x1858000
y.create.l HWIO_GCC_VFE0_CFG_RCGR_ADDR A:0x1858004
y.create.l HWIO_GCC_CAMSS_VFE_BCR_ADDR A:0x1858030
y.create.l HWIO_GCC_CAMSS_VFE_GDSCR_ADDR A:0x1858034
y.create.l HWIO_GCC_CAMSS_VFE0_CBCR_ADDR A:0x1858038
y.create.l HWIO_GCC_CAMSS_VFE_AHB_CBCR_ADDR A:0x1858044
y.create.l HWIO_GCC_CAMSS_VFE_AXI_CBCR_ADDR A:0x1858048
y.create.l HWIO_GCC_CAMSS_CSI_VFE0_BCR_ADDR A:0x185804c
y.create.l HWIO_GCC_CAMSS_CSI_VFE0_CBCR_ADDR A:0x1858050
y.create.l HWIO_GCC_GFX3D_CMD_RCGR_ADDR A:0x1859000
y.create.l HWIO_GCC_GFX3D_CFG_RCGR_ADDR A:0x1859004
y.create.l HWIO_GCC_OXILI_BCR_ADDR A:0x1859018
y.create.l HWIO_GCC_OXILI_GDSCR_ADDR A:0x185901c
y.create.l HWIO_GCC_OXILI_GFX3D_CBCR_ADDR A:0x1859020
y.create.l HWIO_GCC_OXILI_AHB_CBCR_ADDR A:0x1859028
y.create.l HWIO_GCC_CAMSS_TOP_AHB_CMD_RCGR_ADDR A:0x185a000
y.create.l HWIO_GCC_CAMSS_TOP_AHB_CFG_RCGR_ADDR A:0x185a004
y.create.l HWIO_GCC_CAMSS_TOP_AHB_M_ADDR A:0x185a008
y.create.l HWIO_GCC_CAMSS_TOP_AHB_N_ADDR A:0x185a00c
y.create.l HWIO_GCC_CAMSS_TOP_AHB_D_ADDR A:0x185a010
y.create.l HWIO_GCC_GX_DOMAIN_MISC_ADDR A:0x185b00c
y.create.l HWIO_GCC_AUDIO_CORE_BCR_ADDR A:0x181c008
y.create.l HWIO_GCC_ULTAUDIO_LPAIF_PRI_I2S_CMD_RCGR_ADDR A:0x181c054
y.create.l HWIO_GCC_ULTAUDIO_LPAIF_PRI_I2S_CFG_RCGR_ADDR A:0x181c058
y.create.l HWIO_GCC_ULTAUDIO_LPAIF_PRI_I2S_M_ADDR A:0x181c05c
y.create.l HWIO_GCC_ULTAUDIO_LPAIF_PRI_I2S_N_ADDR A:0x181c060
y.create.l HWIO_GCC_ULTAUDIO_LPAIF_PRI_I2S_D_ADDR A:0x181c064
y.create.l HWIO_GCC_ULTAUDIO_LPAIF_PRI_I2S_CBCR_ADDR A:0x181c068
y.create.l HWIO_GCC_ULTAUDIO_LPAIF_SEC_I2S_CMD_RCGR_ADDR A:0x181c06c
y.create.l HWIO_GCC_ULTAUDIO_LPAIF_SEC_I2S_CFG_RCGR_ADDR A:0x181c070
y.create.l HWIO_GCC_ULTAUDIO_LPAIF_SEC_I2S_M_ADDR A:0x181c074
y.create.l HWIO_GCC_ULTAUDIO_LPAIF_SEC_I2S_N_ADDR A:0x181c078
y.create.l HWIO_GCC_ULTAUDIO_LPAIF_SEC_I2S_D_ADDR A:0x181c07c
y.create.l HWIO_GCC_ULTAUDIO_LPAIF_SEC_I2S_CBCR_ADDR A:0x181c080
y.create.l HWIO_GCC_ULTAUDIO_XO_CMD_RCGR_ADDR A:0x181c034
y.create.l HWIO_GCC_ULTAUDIO_XO_CFG_RCGR_ADDR A:0x181c038
y.create.l HWIO_GCC_ULTAUDIO_AHBFABRIC_CMD_RCGR_ADDR A:0x181c010
y.create.l HWIO_GCC_ULTAUDIO_AHBFABRIC_CFG_RCGR_ADDR A:0x181c014
y.create.l HWIO_GCC_ULTAUDIO_AHBFABRIC_M_ADDR A:0x181c018
y.create.l HWIO_GCC_ULTAUDIO_AHBFABRIC_N_ADDR A:0x181c01c
y.create.l HWIO_GCC_ULTAUDIO_AHBFABRIC_D_ADDR A:0x181c020
y.create.l HWIO_GCC_ULTAUDIO_AHBFABRIC_IXFABRIC_LPM_CBCR_ADDR A:0x181c024
y.create.l HWIO_GCC_ULTAUDIO_AHBFABRIC_IXFABRIC_CBCR_ADDR A:0x181c028
y.create.l HWIO_GCC_ULTAUDIO_AVSYNC_XO_CBCR_ADDR A:0x181c04c
y.create.l HWIO_GCC_ULTAUDIO_STC_XO_CBCR_ADDR A:0x181c050
y.create.l HWIO_GCC_ULTAUDIO_AHBFABRIC_EFABRIC_SPDM_CBCR_ADDR A:0x181c030
y.create.l HWIO_GCC_CODEC_DIGCODEC_CMD_RCGR_ADDR A:0x181c09c
y.create.l HWIO_GCC_CODEC_DIGCODEC_CFG_RCGR_ADDR A:0x181c0a0
y.create.l HWIO_GCC_CODEC_DIGCODEC_M_ADDR A:0x181c0a4
y.create.l HWIO_GCC_CODEC_DIGCODEC_N_ADDR A:0x181c0a8
y.create.l HWIO_GCC_CODEC_DIGCODEC_D_ADDR A:0x181c0ac
y.create.l HWIO_GCC_CODEC_DIGCODEC_CBCR_ADDR A:0x181c0b0
y.create.l HWIO_GCC_ULTAUDIO_LPAIF_AUX_I2S_CMD_RCGR_ADDR A:0x181c084
y.create.l HWIO_GCC_ULTAUDIO_LPAIF_AUX_I2S_CFG_RCGR_ADDR A:0x181c088
y.create.l HWIO_GCC_ULTAUDIO_LPAIF_AUX_I2S_M_ADDR A:0x181c08c
y.create.l HWIO_GCC_ULTAUDIO_LPAIF_AUX_I2S_N_ADDR A:0x181c090
y.create.l HWIO_GCC_ULTAUDIO_LPAIF_AUX_I2S_D_ADDR A:0x181c094
y.create.l HWIO_GCC_ULTAUDIO_LPAIF_AUX_I2S_CBCR_ADDR A:0x181c098
y.create.l HWIO_GCC_ULTAUDIO_PCM_DATA_OE_CMD_RCGR_ADDR A:0x181c0f0
y.create.l HWIO_GCC_ULTAUDIO_PCM_DATA_OE_CFG_RCGR_ADDR A:0x181c0f4
y.create.l HWIO_GCC_ULTAUDIO_PCM_DATA_OE_M_ADDR A:0x181c0f8
y.create.l HWIO_GCC_ULTAUDIO_PCM_DATA_OE_N_ADDR A:0x181c0fc
y.create.l HWIO_GCC_ULTAUDIO_PCM_DATA_OE_D_ADDR A:0x181c100
y.create.l HWIO_GCC_ULTAUDIO_PCM_DATA_OE_CBCR_ADDR A:0x181c104
y.create.l HWIO_GCC_ULTAUDIO_EXT_MCLK2_CMD_RCGR_ADDR A:0x181c0d8
y.create.l HWIO_GCC_ULTAUDIO_EXT_MCLK2_CFG_RCGR_ADDR A:0x181c0dc
y.create.l HWIO_GCC_ULTAUDIO_EXT_MCLK2_M_ADDR A:0x181c0e0
y.create.l HWIO_GCC_ULTAUDIO_EXT_MCLK2_N_ADDR A:0x181c0e4
y.create.l HWIO_GCC_ULTAUDIO_EXT_MCLK2_D_ADDR A:0x181c0e8
y.create.l HWIO_GCC_ULTAUDIO_EXT_MCLK2_CBCR_ADDR A:0x181c0ec
y.create.l HWIO_GCC_AUDIO_REF_CLOCK_SEL_ADDR A:0x181c0b8
y.create.l HWIO_GCC_RPU_XPU_SCR_ADDR A:0x1880000
y.create.l HWIO_GCC_RPU_XPU_SWDR_ADDR A:0x1880004
y.create.l HWIO_GCC_RPU_XPU_SEAR0_ADDR A:0x1880040
y.create.l HWIO_GCC_RPU_XPU_SESR_ADDR A:0x1880048
y.create.l HWIO_GCC_RPU_XPU_SESRRESTORE_ADDR A:0x188004c
y.create.l HWIO_GCC_RPU_XPU_SESYNR0_ADDR A:0x1880050
y.create.l HWIO_GCC_RPU_XPU_SESYNR1_ADDR A:0x1880054
y.create.l HWIO_GCC_RPU_XPU_SESYNR2_ADDR A:0x1880058
y.create.l HWIO_GCC_RPU_XPU_MCR_ADDR A:0x1880100
y.create.l HWIO_GCC_RPU_XPU_MEAR0_ADDR A:0x1880140
y.create.l HWIO_GCC_RPU_XPU_MESR_ADDR A:0x1880148
y.create.l HWIO_GCC_RPU_XPU_MESRRESTORE_ADDR A:0x188014c
y.create.l HWIO_GCC_RPU_XPU_MESYNR0_ADDR A:0x1880150
y.create.l HWIO_GCC_RPU_XPU_MESYNR1_ADDR A:0x1880154
y.create.l HWIO_GCC_RPU_XPU_MESYNR2_ADDR A:0x1880158
y.create.l HWIO_GCC_RPU_XPU_CR_ADDR A:0x1880080
y.create.l HWIO_GCC_RPU_XPU_RPU_ACR0_ADDR A:0x18800a0
y.create.l HWIO_GCC_RPU_XPU_EAR0_ADDR A:0x18800c0
y.create.l HWIO_GCC_RPU_XPU_ESR_ADDR A:0x18800c8
y.create.l HWIO_GCC_RPU_XPU_ESRRESTORE_ADDR A:0x18800cc
y.create.l HWIO_GCC_RPU_XPU_ESYNR0_ADDR A:0x18800d0
y.create.l HWIO_GCC_RPU_XPU_ESYNR1_ADDR A:0x18800d4
y.create.l HWIO_GCC_RPU_XPU_ESYNR2_ADDR A:0x18800d8
y.create.l HWIO_GCC_RPU_XPU_IDR0_ADDR A:0x1880074
y.create.l HWIO_GCC_RPU_XPU_IDR1_ADDR A:0x1880078
y.create.l HWIO_GCC_RPU_XPU_REV_ADDR A:0x188007c
y.create.l HWIO_GCC_RPU_XPU_RG0_RACR0_ADDR A:0x1880200
y.create.l HWIO_GCC_RPU_XPU_RG1_RACR0_ADDR A:0x1880280
y.create.l HWIO_GCC_RPU_XPU_RG2_RACR0_ADDR A:0x1880300
y.create.l HWIO_GCC_RPU_XPU_RG3_RACR0_ADDR A:0x1880380
y.create.l HWIO_GCC_RPU_XPU_RG4_RACR0_ADDR A:0x1880400
y.create.l HWIO_GCC_RPU_XPU_RG5_RACR0_ADDR A:0x1880480
y.create.l HWIO_GCC_RPU_XPU_RG6_RACR0_ADDR A:0x1880500
y.create.l HWIO_GCC_RPU_XPU_RG7_RACR0_ADDR A:0x1880580
y.create.l HWIO_GCC_RPU_XPU_RG8_RACR0_ADDR A:0x1880600
y.create.l HWIO_GCC_RPU_XPU_RG9_RACR0_ADDR A:0x1880680
y.create.l HWIO_GCC_RPU_XPU_RG0_WACR0_ADDR A:0x1880220
y.create.l HWIO_GCC_RPU_XPU_RG1_WACR0_ADDR A:0x18802a0
y.create.l HWIO_GCC_RPU_XPU_RG2_WACR0_ADDR A:0x1880320
y.create.l HWIO_GCC_RPU_XPU_RG3_WACR0_ADDR A:0x18803a0
y.create.l HWIO_GCC_RPU_XPU_RG4_WACR0_ADDR A:0x1880420
y.create.l HWIO_GCC_RPU_XPU_RG5_WACR0_ADDR A:0x18804a0
y.create.l HWIO_GCC_RPU_XPU_RG6_WACR0_ADDR A:0x1880520
y.create.l HWIO_GCC_RPU_XPU_RG7_WACR0_ADDR A:0x18805a0
y.create.l HWIO_GCC_RPU_XPU_RG8_WACR0_ADDR A:0x1880620
y.create.l HWIO_GCC_RPU_XPU_RG9_WACR0_ADDR A:0x18806a0
y.create.l HWIO_GCC_RPU_XPU_RG0_SCR_ADDR A:0x1880250
y.create.l HWIO_GCC_RPU_XPU_RG1_SCR_ADDR A:0x18802d0
y.create.l HWIO_GCC_RPU_XPU_RG2_SCR_ADDR A:0x1880350
y.create.l HWIO_GCC_RPU_XPU_RG3_SCR_ADDR A:0x18803d0
y.create.l HWIO_GCC_RPU_XPU_RG4_SCR_ADDR A:0x1880450
y.create.l HWIO_GCC_RPU_XPU_RG5_SCR_ADDR A:0x18804d0
y.create.l HWIO_GCC_RPU_XPU_RG6_SCR_ADDR A:0x1880550
y.create.l HWIO_GCC_RPU_XPU_RG7_SCR_ADDR A:0x18805d0
y.create.l HWIO_GCC_RPU_XPU_RG8_SCR_ADDR A:0x1880650
y.create.l HWIO_GCC_RPU_XPU_RG9_SCR_ADDR A:0x18806d0
y.create.l HWIO_GCC_RPU_XPU_RG0_MCR_ADDR A:0x1880254
y.create.l HWIO_GCC_RPU_XPU_RG1_MCR_ADDR A:0x18802d4
y.create.l HWIO_GCC_RPU_XPU_RG2_MCR_ADDR A:0x1880354
y.create.l HWIO_GCC_RPU_XPU_RG3_MCR_ADDR A:0x18803d4
y.create.l HWIO_GCC_RPU_XPU_RG4_MCR_ADDR A:0x1880454
y.create.l HWIO_GCC_RPU_XPU_RG5_MCR_ADDR A:0x18804d4
y.create.l HWIO_GCC_RPU_XPU_RG6_MCR_ADDR A:0x1880554
y.create.l HWIO_GCC_RPU_XPU_RG7_MCR_ADDR A:0x18805d4
y.create.l HWIO_GCC_RPU_XPU_RG8_MCR_ADDR A:0x1880654
y.create.l HWIO_GCC_RPU_XPU_RG9_MCR_ADDR A:0x18806d4
y.create.l HWIO_TCSR_MUTEX_REG_0_ADDR A:0x1905000
y.create.l HWIO_TCSR_MUTEX_REG_1_ADDR A:0x1906000
y.create.l HWIO_TCSR_MUTEX_REG_2_ADDR A:0x1907000
y.create.l HWIO_TCSR_MUTEX_REG_3_ADDR A:0x1908000
y.create.l HWIO_TCSR_MUTEX_REG_4_ADDR A:0x1909000
y.create.l HWIO_TCSR_MUTEX_REG_5_ADDR A:0x190a000
y.create.l HWIO_TCSR_MUTEX_REG_6_ADDR A:0x190b000
y.create.l HWIO_TCSR_MUTEX_REG_7_ADDR A:0x190c000
y.create.l HWIO_TCSR_MUTEX_REG_8_ADDR A:0x190d000
y.create.l HWIO_TCSR_MUTEX_REG_9_ADDR A:0x190e000
y.create.l HWIO_TCSR_REGS_XPU_SCR_ADDR A:0x1936000
y.create.l HWIO_TCSR_REGS_XPU_SWDR_ADDR A:0x1936004
y.create.l HWIO_TCSR_REGS_XPU_SEAR0_ADDR A:0x1936040
y.create.l HWIO_TCSR_REGS_XPU_SESR_ADDR A:0x1936048
y.create.l HWIO_TCSR_REGS_XPU_SESRRESTORE_ADDR A:0x193604c
y.create.l HWIO_TCSR_REGS_XPU_SESYNR0_ADDR A:0x1936050
y.create.l HWIO_TCSR_REGS_XPU_SESYNR1_ADDR A:0x1936054
y.create.l HWIO_TCSR_REGS_XPU_SESYNR2_ADDR A:0x1936058
y.create.l HWIO_TCSR_REGS_XPU_MCR_ADDR A:0x1936100
y.create.l HWIO_TCSR_REGS_XPU_MEAR0_ADDR A:0x1936140
y.create.l HWIO_TCSR_REGS_XPU_MESR_ADDR A:0x1936148
y.create.l HWIO_TCSR_REGS_XPU_MESRRESTORE_ADDR A:0x193614c
y.create.l HWIO_TCSR_REGS_XPU_MESYNR0_ADDR A:0x1936150
y.create.l HWIO_TCSR_REGS_XPU_MESYNR1_ADDR A:0x1936154
y.create.l HWIO_TCSR_REGS_XPU_MESYNR2_ADDR A:0x1936158
y.create.l HWIO_TCSR_REGS_XPU_CR_ADDR A:0x1936080
y.create.l HWIO_TCSR_REGS_XPU_RPU_ACR0_ADDR A:0x19360a0
y.create.l HWIO_TCSR_REGS_XPU_EAR0_ADDR A:0x19360c0
y.create.l HWIO_TCSR_REGS_XPU_ESR_ADDR A:0x19360c8
y.create.l HWIO_TCSR_REGS_XPU_ESRRESTORE_ADDR A:0x19360cc
y.create.l HWIO_TCSR_REGS_XPU_ESYNR0_ADDR A:0x19360d0
y.create.l HWIO_TCSR_REGS_XPU_ESYNR1_ADDR A:0x19360d4
y.create.l HWIO_TCSR_REGS_XPU_ESYNR2_ADDR A:0x19360d8
y.create.l HWIO_TCSR_REGS_XPU_IDR0_ADDR A:0x1936074
y.create.l HWIO_TCSR_REGS_XPU_IDR1_ADDR A:0x1936078
y.create.l HWIO_TCSR_REGS_XPU_REV_ADDR A:0x193607c
y.create.l HWIO_TCSR_REGS_XPU_RG0_RACR0_ADDR A:0x1936200
y.create.l HWIO_TCSR_REGS_XPU_RG1_RACR0_ADDR A:0x1936280
y.create.l HWIO_TCSR_REGS_XPU_RG2_RACR0_ADDR A:0x1936300
y.create.l HWIO_TCSR_REGS_XPU_RG3_RACR0_ADDR A:0x1936380
y.create.l HWIO_TCSR_REGS_XPU_RG4_RACR0_ADDR A:0x1936400
y.create.l HWIO_TCSR_REGS_XPU_RG5_RACR0_ADDR A:0x1936480
y.create.l HWIO_TCSR_REGS_XPU_RG6_RACR0_ADDR A:0x1936500
y.create.l HWIO_TCSR_REGS_XPU_RG7_RACR0_ADDR A:0x1936580
y.create.l HWIO_TCSR_REGS_XPU_RG8_RACR0_ADDR A:0x1936600
y.create.l HWIO_TCSR_REGS_XPU_RG9_RACR0_ADDR A:0x1936680
y.create.l HWIO_TCSR_REGS_XPU_RG0_WACR0_ADDR A:0x1936220
y.create.l HWIO_TCSR_REGS_XPU_RG1_WACR0_ADDR A:0x19362a0
y.create.l HWIO_TCSR_REGS_XPU_RG2_WACR0_ADDR A:0x1936320
y.create.l HWIO_TCSR_REGS_XPU_RG3_WACR0_ADDR A:0x19363a0
y.create.l HWIO_TCSR_REGS_XPU_RG4_WACR0_ADDR A:0x1936420
y.create.l HWIO_TCSR_REGS_XPU_RG5_WACR0_ADDR A:0x19364a0
y.create.l HWIO_TCSR_REGS_XPU_RG6_WACR0_ADDR A:0x1936520
y.create.l HWIO_TCSR_REGS_XPU_RG7_WACR0_ADDR A:0x19365a0
y.create.l HWIO_TCSR_REGS_XPU_RG8_WACR0_ADDR A:0x1936620
y.create.l HWIO_TCSR_REGS_XPU_RG9_WACR0_ADDR A:0x19366a0
y.create.l HWIO_TCSR_REGS_XPU_RG0_SCR_ADDR A:0x1936250
y.create.l HWIO_TCSR_REGS_XPU_RG1_SCR_ADDR A:0x19362d0
y.create.l HWIO_TCSR_REGS_XPU_RG2_SCR_ADDR A:0x1936350
y.create.l HWIO_TCSR_REGS_XPU_RG3_SCR_ADDR A:0x19363d0
y.create.l HWIO_TCSR_REGS_XPU_RG4_SCR_ADDR A:0x1936450
y.create.l HWIO_TCSR_REGS_XPU_RG5_SCR_ADDR A:0x19364d0
y.create.l HWIO_TCSR_REGS_XPU_RG6_SCR_ADDR A:0x1936550
y.create.l HWIO_TCSR_REGS_XPU_RG7_SCR_ADDR A:0x19365d0
y.create.l HWIO_TCSR_REGS_XPU_RG8_SCR_ADDR A:0x1936650
y.create.l HWIO_TCSR_REGS_XPU_RG9_SCR_ADDR A:0x19366d0
y.create.l HWIO_TCSR_REGS_XPU_RG0_MCR_ADDR A:0x1936254
y.create.l HWIO_TCSR_REGS_XPU_RG1_MCR_ADDR A:0x19362d4
y.create.l HWIO_TCSR_REGS_XPU_RG2_MCR_ADDR A:0x1936354
y.create.l HWIO_TCSR_REGS_XPU_RG3_MCR_ADDR A:0x19363d4
y.create.l HWIO_TCSR_REGS_XPU_RG4_MCR_ADDR A:0x1936454
y.create.l HWIO_TCSR_REGS_XPU_RG5_MCR_ADDR A:0x19364d4
y.create.l HWIO_TCSR_REGS_XPU_RG6_MCR_ADDR A:0x1936554
y.create.l HWIO_TCSR_REGS_XPU_RG7_MCR_ADDR A:0x19365d4
y.create.l HWIO_TCSR_REGS_XPU_RG8_MCR_ADDR A:0x1936654
y.create.l HWIO_TCSR_REGS_XPU_RG9_MCR_ADDR A:0x19366d4
y.create.l HWIO_TCSR_BIMC_CFG_QRIB_XPU2_INIT_ADDR A:0x1937100
y.create.l HWIO_TCSR_BIMC_QXS0_QRIB_XPU2_INIT_ADDR A:0x1937104
y.create.l HWIO_TCSR_MMSS_VENUS0_VBIF_QRIB_XPU2_INIT_ADDR A:0x1937380
y.create.l HWIO_TCSR_MMSS_VENUS0_WRAPPER_QRIB_XPU2_INIT_ADDR A:0x1937384
y.create.l HWIO_TCSR_BIMC_CFG_QRIB_XPU2_ACR_ADDR A:0x1938000
y.create.l HWIO_TCSR_BIMC_CFG_QRIB_XPU2_VMIDEN_INIT_ADDR A:0x1938004
y.create.l HWIO_TCSR_BIMC_QXS0_QRIB_XPU2_ACR_ADDR A:0x1938008
y.create.l HWIO_TCSR_BIMC_QXS0_QRIB_XPU2_VMIDEN_INIT_ADDR A:0x193800c
y.create.l HWIO_TCSR_MMSS_VENUS0_VBIF_QRIB_XPU2_ACR_ADDR A:0x1938380
y.create.l HWIO_TCSR_MMSS_VENUS0_VBIF_QRIB_XPU2_VMIDEN_INIT_ADDR A:0x1938384
y.create.l HWIO_TCSR_MMSS_VENUS0_WRAPPER_QRIB_XPU2_ACR_ADDR A:0x1938390
y.create.l HWIO_TCSR_MMSS_VENUS0_WRAPPER_QRIB_XPU2_VMIDEN_INIT_ADDR A:0x1938394
y.create.l HWIO_TCSR_SS_XPU2_NON_SEC_INTR0_ADDR A:0x1939000
y.create.l HWIO_TCSR_SS_XPU2_NON_SEC_INTR0_ENABLE_ADDR A:0x1939040
y.create.l HWIO_TCSR_SS_VMIDMT_CLIENT_NON_SEC_INTR_ADDR A:0x1939010
y.create.l HWIO_TCSR_SS_VMIDMT_CLIENT_NON_SEC_INTR_ENABLE_ADDR A:0x1939050
y.create.l HWIO_TCSR_SS_VMIDMT_CFG_NON_SEC_INTR_ADDR A:0x1939090
y.create.l HWIO_TCSR_SS_VMIDMT_CFG_NON_SEC_INTR_ENABLE_ADDR A:0x19390d0
y.create.l HWIO_TCSR_MUTEX_REG_RESET_ADDR A:0x1939800
y.create.l HWIO_TCSR_SS_XPU2_SEC_INTR0_ADDR A:0x1939400
y.create.l HWIO_TCSR_SS_XPU2_SEC_INTR0_ENABLE_ADDR A:0x1939440
y.create.l HWIO_TCSR_SS_VMIDMT_CLIENT_SEC_INTR_ADDR A:0x1939410
y.create.l HWIO_TCSR_SS_VMIDMT_CLIENT_SEC_INTR_ENABLE_ADDR A:0x1939450
y.create.l HWIO_TCSR_SS_VMIDMT_CFG_SEC_INTR_ADDR A:0x1939490
y.create.l HWIO_TCSR_SS_VMIDMT_CFG_SEC_INTR_ENABLE_ADDR A:0x19394d0
y.create.l HWIO_TCSR_SS_XPU2_MSA_INTR0_ADDR A:0x193a000
y.create.l HWIO_TCSR_SS_XPU2_MSA_INTR0_ENABLE_ADDR A:0x193a010
y.create.l HWIO_TCSR_MSA_BIT_REG_ADDR A:0x193a100
y.create.l HWIO_TCSR_TCSR_CLK_EN_ADDR A:0x193b07c
y.create.l HWIO_TCSR_TIMEOUT_SLAVE_GLB_EN_ADDR A:0x193c000
y.create.l HWIO_TCSR_XPU_NSEN_STATUS_ADDR A:0x193c004
y.create.l HWIO_TCSR_XPU_VMIDEN_STATUS_ADDR A:0x193c008
y.create.l HWIO_TCSR_XPU_MSAEN_STATUS_ADDR A:0x193c00c
y.create.l HWIO_TCSR_MDP3_TIMEOUT_VAL_0_ADDR_ADDR A:0x193c014
y.create.l HWIO_TCSR_MDP3_TIMEOUT_VAL_1_ADDR_ADDR A:0x193c018
y.create.l HWIO_TCSR_MDP3_TIMEOUT_EN_ADDR A:0x193c01c
y.create.l HWIO_TCSR_TZ_WONCE_0_ADDR A:0x193d000
y.create.l HWIO_TCSR_TZ_WONCE_1_ADDR A:0x193d004
y.create.l HWIO_TCSR_TZ_WONCE_2_ADDR A:0x193d008
y.create.l HWIO_TCSR_TZ_WONCE_3_ADDR A:0x193d00c
y.create.l HWIO_TCSR_TZ_WONCE_4_ADDR A:0x193d010
y.create.l HWIO_TCSR_TZ_WONCE_5_ADDR A:0x193d014
y.create.l HWIO_TCSR_TZ_WONCE_6_ADDR A:0x193d018
y.create.l HWIO_TCSR_TZ_WONCE_7_ADDR A:0x193d01c
y.create.l HWIO_TCSR_TZ_WONCE_8_ADDR A:0x193d020
y.create.l HWIO_TCSR_TZ_WONCE_9_ADDR A:0x193d024
y.create.l HWIO_TCSR_GCC_CLK_MUX_SEL_ADDR A:0x193d0f0
y.create.l HWIO_TCSR_BOOT_MISC_DETECT_ADDR A:0x193d100
y.create.l HWIO_TCSR_APSS_VMID_ADDR A:0x193d110
y.create.l HWIO_TCSR_MMSS_RPM_IRQ_EN_ADDR A:0x193e000
y.create.l HWIO_TCSR_MMSS_RPM_IRQ_CLEAR_ADDR A:0x193e004
y.create.l HWIO_TCSR_MMSS_RPM_IRQ_STATUS_ADDR A:0x193e008
y.create.l HWIO_TCSR_MMSS_OXILI_GC_SYS_AHB_STATUS_ADDR A:0x193e010
y.create.l HWIO_TCSR_MMSS_OXILI_CMD_REG_ADDR A:0x193e014
y.create.l HWIO_TCSR_MMSS_DSI_ULP_CLAMP_CTRL_ADDR A:0x193e020
y.create.l HWIO_TCSR_MMSS_DSI_PHYRESET_CTRL_ADDR A:0x193e024
y.create.l HWIO_TCSR_MMSS_IMEM_FSCGC_TIMERS_ADDR A:0x193e030
y.create.l HWIO_TCSR_MMSS_IMEM_EX_FSCGC_CONTROL_ADDR A:0x193e034
y.create.l HWIO_TCSR_MMSS_IMEM_RAM_CONFIG_ADDR A:0x193e038
y.create.l HWIO_TCSR_TBU_BYPASS_ENABLE_ADDR A:0x193f000
y.create.l HWIO_TCSR_RESET_DEBUG_SW_ENTRY_ADDR A:0x1940000
y.create.l HWIO_TCSR_QPDI_DISABLE_CFG_ADDR A:0x1941000
y.create.l HWIO_TCSR_COMPILER_VDDCX_ACC_0_ADDR A:0x1942080
y.create.l HWIO_TCSR_COMPILER_VDDCX_ACC_1_ADDR A:0x1942084
y.create.l HWIO_TCSR_CUSTOM_VDDCX_ACC_0_ADDR A:0x1942090
y.create.l HWIO_TCSR_CUSTOM_VDDCX_ACC_1_ADDR A:0x1942094
y.create.l HWIO_TCSR_MEM_ACC_SEL_VDDCX_ADDR A:0x1942100
y.create.l HWIO_TCSR_TCSR_S1LM_MODEM_TO_APPS_INT_ADDR A:0x1946000
y.create.l HWIO_TCSR_TCSR_S1LM_MODEM_TO_APPS_INT_DATA_ADDR A:0x1946004
y.create.l HWIO_TCSR_SPARE_APU_REG2_ADDR A:0x1946008
y.create.l HWIO_TCSR_SPARE_APU_REG3_ADDR A:0x194600c
y.create.l HWIO_TCSR_SYS_POWER_CTRL_ADDR A:0x1947000
y.create.l HWIO_TCSR_USB_CORE_ID_ADDR A:0x1947004
y.create.l HWIO_TCSR_TEST_SPARE_CFG_REG_ADDR_ADDR A:0x1947508
y.create.l HWIO_TCSR_COMPILER_VDDMSS_ACC_0_ADDR A:0x1942104
y.create.l HWIO_TCSR_COMPILER_VDDMSS_ACC_1_ADDR A:0x1942108
y.create.l HWIO_TCSR_COMPILER_VDDAPC_ACC_0_ADDR A:0x194210c
y.create.l HWIO_TCSR_COMPILER_VDDAPC_ACC_1_ADDR A:0x1942110
y.create.l HWIO_TCSR_CUSTOM_VDDAPC_ACC_0_ADDR A:0x1942120
y.create.l HWIO_TCSR_CUSTOM_VDDAPC_ACC_1_ADDR A:0x1942124
y.create.l HWIO_TCSR_CUSTOM_VDDAPC_ACC_2_ADDR A:0x1942128
y.create.l HWIO_TCSR_MEM_ACC_SEL_VDDMSS_ADDR A:0x194212c
y.create.l HWIO_TCSR_MEM_ACC_SEL_VDDAPC_ADDR A:0x1942130
y.create.l HWIO_TCSR_CUSTOM_VDDCX_ACC_2_ADDR A:0x1942134
y.create.l HWIO_TCSR_LDO_SLEEP_CTRL_ADDR A:0x1948000
y.create.l HWIO_TCSR_LDO_UPDATE_STATE_CTRL_ADDR A:0x1948004
y.create.l HWIO_TCSR_LDO_OBIAS_CTRL_ADDR A:0x1948008
y.create.l HWIO_TCSR_LDO_VREF_CONFIG_ADDR A:0x194800c
y.create.l HWIO_TCSR_LDO_IB_CONFIG_ADDR A:0x1948010
y.create.l HWIO_TCSR_LDO_BGC_CONFIG_ADDR A:0x1948014
y.create.l HWIO_TCSR_LDO_VREF_CTRL_ADDR A:0x1948018
y.create.l HWIO_TCSR_LDO_LD_EN_ADDR A:0x194801c
y.create.l HWIO_TCSR_LDO_LD_CTRL_ADDR A:0x1948020
y.create.l HWIO_TCSR_LDO_OSC_RESETB_ADDR A:0x1948024
y.create.l HWIO_TCSR_LDO_OSC_CTRL_ADDR A:0x1948028
y.create.l HWIO_TCSR_LDO_DFT_EN_CTRL_ADDR A:0x194802c
y.create.l HWIO_TCSR_LDO_DFT_CTRL_ADDR A:0x1948030
y.create.l HWIO_TCSR_SPDM_CNT_CLK_CTRL_ADDR A:0x194a000
y.create.l HWIO_TCSR_SPDM_DLY_FIFO_EN_ADDR A:0x194a004
y.create.l HWIO_TCSR_SPDM_STG1_MUX_SEL_ADDR A:0x194a008
y.create.l HWIO_TCSR_SPDM_STG2_A_MUX_SEL_ADDR A:0x194a00c
y.create.l HWIO_TCSR_SPDM_STG2_B_MUX_SEL_ADDR A:0x194a010
y.create.l HWIO_TCSR_SPDM_STG3_A_MUX_SEL_ADDR A:0x194a014
y.create.l HWIO_TCSR_SPDM_STG3_B_MUX_SEL_ADDR A:0x194a018
y.create.l HWIO_TCSR_PHSS_USB2_PHY_SEL_ADDR A:0x194b000
y.create.l HWIO_TCSR_PHSS_ATEST_USB2_PHY_SEL_ADDR A:0x194b004
y.create.l HWIO_TCSR_PHSS_TEST_BUS_SEL_ADDR A:0x194b008
y.create.l HWIO_TCSR_PHSS_UART_PRONTO_INT_SEL_0_ADDR A:0x194b080
y.create.l HWIO_TCSR_PHSS_UART_PRONTO_INT_SEL_1_ADDR A:0x194b090
y.create.l HWIO_TCSR_PHSS_UART_MSS_INT_SEL_0_ADDR A:0x194b0c0
y.create.l HWIO_TCSR_PHSS_UART_MSS_INT_SEL_1_ADDR A:0x194b0d0
y.create.l HWIO_TCSR_PHSS_QUP_PRONTO_INT_SEL_0_ADDR A:0x194b100
y.create.l HWIO_TCSR_PHSS_QUP_PRONTO_INT_SEL_1_ADDR A:0x194b110
y.create.l HWIO_TCSR_PHSS_QUP_MSS_INT_SEL_0_ADDR A:0x194b140
y.create.l HWIO_TCSR_PHSS_QUP_MSS_INT_SEL_1_ADDR A:0x194b150
y.create.l HWIO_TCSR_MEM_ARRY_STBY_ADDR A:0x194c180
y.create.l HWIO_TCSR_SOC_HW_VERSION_ADDR A:0x194d000
y.create.l HWIO_TCSR_TIMEOUT_INTR_STATUS_ADDR A:0x194d020
y.create.l HWIO_TCSR_TIMEOUT_INTR_RPM_ENABLE_ADDR A:0x194d030
y.create.l HWIO_TCSR_TIMEOUT_INTR_APSS_ENABLE_ADDR A:0x194d040
y.create.l HWIO_TCSR_TIMEOUT_INTR_MSS_ENABLE_ADDR A:0x194d060
y.create.l HWIO_TCSR_PRONTO_BUS_TIMEOUT_RESET_ADDR A:0x194d070
y.create.l HWIO_TCSR_CRYPTO0_HALTREQ_ADDR A:0x194e000
y.create.l HWIO_TCSR_CRYPTO0_HALTACK_ADDR A:0x194e004
y.create.l HWIO_TCSR_CRYPTO0_MASTER_IDLE_ADDR A:0x194e008
y.create.l HWIO_TCSR_MSSQ6_HALTREQ_ADDR A:0x194f000
y.create.l HWIO_TCSR_MSSQ6_HALTACK_ADDR A:0x194f004
y.create.l HWIO_TCSR_MSSQ6_MASTER_IDLE_ADDR A:0x194f008
y.create.l HWIO_TCSR_MSSQ6_POWER_STATE_ADDR A:0x194f010
y.create.l HWIO_TCSR_MSS_MODEM_HALTREQ_ADDR A:0x1950000
y.create.l HWIO_TCSR_MSS_MODEM_HALTACK_ADDR A:0x1950004
y.create.l HWIO_TCSR_MSS_MODEM_MASTER_IDLE_ADDR A:0x1950008
y.create.l HWIO_TCSR_MSS_NC_HALTREQ_ADDR A:0x1951000
y.create.l HWIO_TCSR_MSS_NC_HALTACK_ADDR A:0x1951004
y.create.l HWIO_TCSR_MSS_NC_MASTER_IDLE_ADDR A:0x1951008
y.create.l HWIO_TCSR_WCSS_HALTREQ_ADDR A:0x1952000
y.create.l HWIO_TCSR_WCSS_HALTACK_ADDR A:0x1952004
y.create.l HWIO_TCSR_WCSS_MASTER_IDLE_ADDR A:0x1952008
y.create.l HWIO_TCSR_SDC1_HALTREQ_ADDR A:0x1953000
y.create.l HWIO_TCSR_SDC1_HALTACK_ADDR A:0x1953004
y.create.l HWIO_TCSR_SDC1_MASTER_IDLE_ADDR A:0x1953008
y.create.l HWIO_TCSR_SDC2_HALTREQ_ADDR A:0x1954000
y.create.l HWIO_TCSR_SDC2_HALTACK_ADDR A:0x1954004
y.create.l HWIO_TCSR_SDC2_MASTER_IDLE_ADDR A:0x1954008
y.create.l HWIO_TCSR_ULT_AUDIO_CORE_ABORT_REQ_ADDR A:0x1955000
y.create.l HWIO_TCSR_ULT_AUDIO_CORE_ABORT_ACK_ADDR A:0x1955004
y.create.l HWIO_TCSR_TCSR_S1LM_APPS_TO_MODEM_INT_ADDR A:0x1956000
y.create.l HWIO_TCSR_TCSR_S1LM_APPS_TO_MODEM_INT_DATA_ADDR A:0x1956004
y.create.l HWIO_TCSR_SPARE_REG2_ADDR A:0x1956008
y.create.l HWIO_TCSR_SPARE_REG3_ADDR A:0x195600c
y.create.l HWIO_TCSR_PNOC_SNOC_MEMTYPE_ADDR A:0x1957000
y.create.l HWIO_CRYPTO0_CRYPTO_VERSION_ADDR A:0x73a000
y.create.l HWIO_CRYPTO0_CRYPTO_DATA_IN0_ADDR A:0x73a010
y.create.l HWIO_CRYPTO0_CRYPTO_DATA_IN1_ADDR A:0x73a014
y.create.l HWIO_CRYPTO0_CRYPTO_DATA_IN2_ADDR A:0x73a018
y.create.l HWIO_CRYPTO0_CRYPTO_DATA_IN3_ADDR A:0x73a01c
y.create.l HWIO_CRYPTO0_CRYPTO_DATA_OUT0_ADDR A:0x73a020
y.create.l HWIO_CRYPTO0_CRYPTO_DATA_OUT1_ADDR A:0x73a024
y.create.l HWIO_CRYPTO0_CRYPTO_DATA_OUT2_ADDR A:0x73a028
y.create.l HWIO_CRYPTO0_CRYPTO_DATA_OUT3_ADDR A:0x73a02c
y.create.l HWIO_CRYPTO0_CRYPTO_STATUS_ADDR A:0x73a100
y.create.l HWIO_CRYPTO0_CRYPTO_STATUS2_ADDR A:0x73a104
y.create.l HWIO_CRYPTO0_CRYPTO_ENGINES_AVAIL_ADDR A:0x73a108
y.create.l HWIO_CRYPTO0_CRYPTO_FIFO_SIZES_ADDR A:0x73a10c
y.create.l HWIO_CRYPTO0_CRYPTO_SEG_SIZE_ADDR A:0x73a110
y.create.l HWIO_CRYPTO0_CRYPTO_GOPROC_ADDR A:0x73a120
y.create.l HWIO_CRYPTO0_CRYPTO_GOPROC_QC_KEY_ADDR A:0x73b000
y.create.l HWIO_CRYPTO0_CRYPTO_GOPROC_OEM_KEY_ADDR A:0x73c000
y.create.l HWIO_CRYPTO0_CRYPTO_ENCR_SEG_CFG_ADDR A:0x73a200
y.create.l HWIO_CRYPTO0_CRYPTO_ENCR_SEG_SIZE_ADDR A:0x73a204
y.create.l HWIO_CRYPTO0_CRYPTO_ENCR_SEG_START_ADDR A:0x73a208
y.create.l HWIO_CRYPTO0_CRYPTO_ENCR_KEY0_ADDR A:0x73d000
y.create.l HWIO_CRYPTO0_CRYPTO_ENCR_KEY1_ADDR A:0x73d004
y.create.l HWIO_CRYPTO0_CRYPTO_ENCR_KEY2_ADDR A:0x73d008
y.create.l HWIO_CRYPTO0_CRYPTO_ENCR_KEY3_ADDR A:0x73d00c
y.create.l HWIO_CRYPTO0_CRYPTO_ENCR_KEY4_ADDR A:0x73d010
y.create.l HWIO_CRYPTO0_CRYPTO_ENCR_KEY5_ADDR A:0x73d014
y.create.l HWIO_CRYPTO0_CRYPTO_ENCR_KEY6_ADDR A:0x73d018
y.create.l HWIO_CRYPTO0_CRYPTO_ENCR_KEY7_ADDR A:0x73d01c
y.create.l HWIO_CRYPTO0_CRYPTO_ENCR_PIPE0_KEY0_ADDR A:0x73e000
y.create.l HWIO_CRYPTO0_CRYPTO_ENCR_PIPE0_KEY1_ADDR A:0x73e004
y.create.l HWIO_CRYPTO0_CRYPTO_ENCR_PIPE0_KEY2_ADDR A:0x73e008
y.create.l HWIO_CRYPTO0_CRYPTO_ENCR_PIPE0_KEY3_ADDR A:0x73e00c
y.create.l HWIO_CRYPTO0_CRYPTO_ENCR_PIPE1_KEY0_ADDR A:0x73e020
y.create.l HWIO_CRYPTO0_CRYPTO_ENCR_PIPE1_KEY1_ADDR A:0x73e024
y.create.l HWIO_CRYPTO0_CRYPTO_ENCR_PIPE1_KEY2_ADDR A:0x73e028
y.create.l HWIO_CRYPTO0_CRYPTO_ENCR_PIPE1_KEY3_ADDR A:0x73e02c
y.create.l HWIO_CRYPTO0_CRYPTO_ENCR_PIPE2_KEY0_ADDR A:0x73e040
y.create.l HWIO_CRYPTO0_CRYPTO_ENCR_PIPE2_KEY1_ADDR A:0x73e044
y.create.l HWIO_CRYPTO0_CRYPTO_ENCR_PIPE2_KEY2_ADDR A:0x73e048
y.create.l HWIO_CRYPTO0_CRYPTO_ENCR_PIPE2_KEY3_ADDR A:0x73e04c
y.create.l HWIO_CRYPTO0_CRYPTO_ENCR_PIPE3_KEY0_ADDR A:0x73e060
y.create.l HWIO_CRYPTO0_CRYPTO_ENCR_PIPE3_KEY1_ADDR A:0x73e064
y.create.l HWIO_CRYPTO0_CRYPTO_ENCR_PIPE3_KEY2_ADDR A:0x73e068
y.create.l HWIO_CRYPTO0_CRYPTO_ENCR_PIPE3_KEY3_ADDR A:0x73e06c
y.create.l HWIO_CRYPTO0_CRYPTO_ENCR_XTS_KEY0_ADDR A:0x73d020
y.create.l HWIO_CRYPTO0_CRYPTO_ENCR_XTS_KEY1_ADDR A:0x73d024
y.create.l HWIO_CRYPTO0_CRYPTO_ENCR_XTS_KEY2_ADDR A:0x73d028
y.create.l HWIO_CRYPTO0_CRYPTO_ENCR_XTS_KEY3_ADDR A:0x73d02c
y.create.l HWIO_CRYPTO0_CRYPTO_ENCR_XTS_KEY4_ADDR A:0x73d030
y.create.l HWIO_CRYPTO0_CRYPTO_ENCR_XTS_KEY5_ADDR A:0x73d034
y.create.l HWIO_CRYPTO0_CRYPTO_ENCR_XTS_KEY6_ADDR A:0x73d038
y.create.l HWIO_CRYPTO0_CRYPTO_ENCR_XTS_KEY7_ADDR A:0x73d03c
y.create.l HWIO_CRYPTO0_CRYPTO_ENCR_PIPE0_XTS_KEY0_ADDR A:0x73e200
y.create.l HWIO_CRYPTO0_CRYPTO_ENCR_PIPE0_XTS_KEY1_ADDR A:0x73e204
y.create.l HWIO_CRYPTO0_CRYPTO_ENCR_PIPE0_XTS_KEY2_ADDR A:0x73e208
y.create.l HWIO_CRYPTO0_CRYPTO_ENCR_PIPE0_XTS_KEY3_ADDR A:0x73e20c
y.create.l HWIO_CRYPTO0_CRYPTO_ENCR_PIPE1_XTS_KEY0_ADDR A:0x73e220
y.create.l HWIO_CRYPTO0_CRYPTO_ENCR_PIPE1_XTS_KEY1_ADDR A:0x73e224
y.create.l HWIO_CRYPTO0_CRYPTO_ENCR_PIPE1_XTS_KEY2_ADDR A:0x73e228
y.create.l HWIO_CRYPTO0_CRYPTO_ENCR_PIPE1_XTS_KEY3_ADDR A:0x73e22c
y.create.l HWIO_CRYPTO0_CRYPTO_ENCR_PIPE2_XTS_KEY0_ADDR A:0x73e240
y.create.l HWIO_CRYPTO0_CRYPTO_ENCR_PIPE2_XTS_KEY1_ADDR A:0x73e244
y.create.l HWIO_CRYPTO0_CRYPTO_ENCR_PIPE2_XTS_KEY2_ADDR A:0x73e248
y.create.l HWIO_CRYPTO0_CRYPTO_ENCR_PIPE2_XTS_KEY3_ADDR A:0x73e24c
y.create.l HWIO_CRYPTO0_CRYPTO_ENCR_PIPE3_XTS_KEY0_ADDR A:0x73e260
y.create.l HWIO_CRYPTO0_CRYPTO_ENCR_PIPE3_XTS_KEY1_ADDR A:0x73e264
y.create.l HWIO_CRYPTO0_CRYPTO_ENCR_PIPE3_XTS_KEY2_ADDR A:0x73e268
y.create.l HWIO_CRYPTO0_CRYPTO_ENCR_PIPE3_XTS_KEY3_ADDR A:0x73e26c
y.create.l HWIO_CRYPTO0_CRYPTO_ENCR_PIPE0_ODD_KEY0_ADDR A:0x73e400
y.create.l HWIO_CRYPTO0_CRYPTO_ENCR_PIPE0_ODD_KEY1_ADDR A:0x73e404
y.create.l HWIO_CRYPTO0_CRYPTO_ENCR_PIPE0_ODD_KEY2_ADDR A:0x73e408
y.create.l HWIO_CRYPTO0_CRYPTO_ENCR_PIPE0_ODD_KEY3_ADDR A:0x73e40c
y.create.l HWIO_CRYPTO0_CRYPTO_ENCR_PIPE1_ODD_KEY0_ADDR A:0x73e420
y.create.l HWIO_CRYPTO0_CRYPTO_ENCR_PIPE1_ODD_KEY1_ADDR A:0x73e424
y.create.l HWIO_CRYPTO0_CRYPTO_ENCR_PIPE1_ODD_KEY2_ADDR A:0x73e428
y.create.l HWIO_CRYPTO0_CRYPTO_ENCR_PIPE1_ODD_KEY3_ADDR A:0x73e42c
y.create.l HWIO_CRYPTO0_CRYPTO_ENCR_PIPE2_ODD_KEY0_ADDR A:0x73e440
y.create.l HWIO_CRYPTO0_CRYPTO_ENCR_PIPE2_ODD_KEY1_ADDR A:0x73e444
y.create.l HWIO_CRYPTO0_CRYPTO_ENCR_PIPE2_ODD_KEY2_ADDR A:0x73e448
y.create.l HWIO_CRYPTO0_CRYPTO_ENCR_PIPE2_ODD_KEY3_ADDR A:0x73e44c
y.create.l HWIO_CRYPTO0_CRYPTO_ENCR_PIPE3_ODD_KEY0_ADDR A:0x73e460
y.create.l HWIO_CRYPTO0_CRYPTO_ENCR_PIPE3_ODD_KEY1_ADDR A:0x73e464
y.create.l HWIO_CRYPTO0_CRYPTO_ENCR_PIPE3_ODD_KEY2_ADDR A:0x73e468
y.create.l HWIO_CRYPTO0_CRYPTO_ENCR_PIPE3_ODD_KEY3_ADDR A:0x73e46c
y.create.l HWIO_CRYPTO0_CRYPTO_ENCR_PIPE0_XTS_ODD_KEY0_ADDR A:0x73e600
y.create.l HWIO_CRYPTO0_CRYPTO_ENCR_PIPE0_XTS_ODD_KEY1_ADDR A:0x73e604
y.create.l HWIO_CRYPTO0_CRYPTO_ENCR_PIPE0_XTS_ODD_KEY2_ADDR A:0x73e608
y.create.l HWIO_CRYPTO0_CRYPTO_ENCR_PIPE0_XTS_ODD_KEY3_ADDR A:0x73e60c
y.create.l HWIO_CRYPTO0_CRYPTO_ENCR_PIPE1_XTS_ODD_KEY0_ADDR A:0x73e620
y.create.l HWIO_CRYPTO0_CRYPTO_ENCR_PIPE1_XTS_ODD_KEY1_ADDR A:0x73e624
y.create.l HWIO_CRYPTO0_CRYPTO_ENCR_PIPE1_XTS_ODD_KEY2_ADDR A:0x73e628
y.create.l HWIO_CRYPTO0_CRYPTO_ENCR_PIPE1_XTS_ODD_KEY3_ADDR A:0x73e62c
y.create.l HWIO_CRYPTO0_CRYPTO_ENCR_PIPE2_XTS_ODD_KEY0_ADDR A:0x73e640
y.create.l HWIO_CRYPTO0_CRYPTO_ENCR_PIPE2_XTS_ODD_KEY1_ADDR A:0x73e644
y.create.l HWIO_CRYPTO0_CRYPTO_ENCR_PIPE2_XTS_ODD_KEY2_ADDR A:0x73e648
y.create.l HWIO_CRYPTO0_CRYPTO_ENCR_PIPE2_XTS_ODD_KEY3_ADDR A:0x73e64c
y.create.l HWIO_CRYPTO0_CRYPTO_ENCR_PIPE3_XTS_ODD_KEY0_ADDR A:0x73e660
y.create.l HWIO_CRYPTO0_CRYPTO_ENCR_PIPE3_XTS_ODD_KEY1_ADDR A:0x73e664
y.create.l HWIO_CRYPTO0_CRYPTO_ENCR_PIPE3_XTS_ODD_KEY2_ADDR A:0x73e668
y.create.l HWIO_CRYPTO0_CRYPTO_ENCR_PIPE3_XTS_ODD_KEY3_ADDR A:0x73e66c
y.create.l HWIO_CRYPTO0_CRYPTO_ENCR_CNTR0_IV0_ADDR A:0x73a20c
y.create.l HWIO_CRYPTO0_CRYPTO_ENCR_CNTR1_IV1_ADDR A:0x73a210
y.create.l HWIO_CRYPTO0_CRYPTO_ENCR_CNTR2_IV2_ADDR A:0x73a214
y.create.l HWIO_CRYPTO0_CRYPTO_ENCR_CNTR3_IV3_ADDR A:0x73a218
y.create.l HWIO_CRYPTO0_CRYPTO_ENCR_CNTR_MASK_ADDR A:0x73a21c
y.create.l HWIO_CRYPTO0_CRYPTO_ENCR_CNTR_MASK2_ADDR A:0x73a234
y.create.l HWIO_CRYPTO0_CRYPTO_ENCR_CNTR_MASK1_ADDR A:0x73a238
y.create.l HWIO_CRYPTO0_CRYPTO_ENCR_CNTR_MASK0_ADDR A:0x73a23c
y.create.l HWIO_CRYPTO0_CRYPTO_ENCR_CCM_INIT_CNTR0_ADDR A:0x73a220
y.create.l HWIO_CRYPTO0_CRYPTO_ENCR_CCM_INIT_CNTR1_ADDR A:0x73a224
y.create.l HWIO_CRYPTO0_CRYPTO_ENCR_CCM_INIT_CNTR2_ADDR A:0x73a228
y.create.l HWIO_CRYPTO0_CRYPTO_ENCR_CCM_INIT_CNTR3_ADDR A:0x73a22c
y.create.l HWIO_CRYPTO0_CRYPTO_ENCR_XTS_DU_SIZE_ADDR A:0x73a230
y.create.l HWIO_CRYPTO0_CRYPTO_AUTH_SEG_CFG_ADDR A:0x73a300
y.create.l HWIO_CRYPTO0_CRYPTO_AUTH_SEG_SIZE_ADDR A:0x73a304
y.create.l HWIO_CRYPTO0_CRYPTO_AUTH_SEG_START_ADDR A:0x73a308
y.create.l HWIO_CRYPTO0_CRYPTO_AUTH_KEY0_ADDR A:0x73d040
y.create.l HWIO_CRYPTO0_CRYPTO_AUTH_KEY1_ADDR A:0x73d044
y.create.l HWIO_CRYPTO0_CRYPTO_AUTH_KEY2_ADDR A:0x73d048
y.create.l HWIO_CRYPTO0_CRYPTO_AUTH_KEY3_ADDR A:0x73d04c
y.create.l HWIO_CRYPTO0_CRYPTO_AUTH_KEY4_ADDR A:0x73d050
y.create.l HWIO_CRYPTO0_CRYPTO_AUTH_KEY5_ADDR A:0x73d054
y.create.l HWIO_CRYPTO0_CRYPTO_AUTH_KEY6_ADDR A:0x73d058
y.create.l HWIO_CRYPTO0_CRYPTO_AUTH_KEY7_ADDR A:0x73d05c
y.create.l HWIO_CRYPTO0_CRYPTO_AUTH_KEY8_ADDR A:0x73d060
y.create.l HWIO_CRYPTO0_CRYPTO_AUTH_KEY9_ADDR A:0x73d064
y.create.l HWIO_CRYPTO0_CRYPTO_AUTH_PIPE0_KEY0_ADDR A:0x73e800
y.create.l HWIO_CRYPTO0_CRYPTO_AUTH_PIPE0_KEY1_ADDR A:0x73e804
y.create.l HWIO_CRYPTO0_CRYPTO_AUTH_PIPE0_KEY2_ADDR A:0x73e808
y.create.l HWIO_CRYPTO0_CRYPTO_AUTH_PIPE0_KEY3_ADDR A:0x73e80c
y.create.l HWIO_CRYPTO0_CRYPTO_AUTH_PIPE1_KEY0_ADDR A:0x73e880
y.create.l HWIO_CRYPTO0_CRYPTO_AUTH_PIPE1_KEY1_ADDR A:0x73e884
y.create.l HWIO_CRYPTO0_CRYPTO_AUTH_PIPE1_KEY2_ADDR A:0x73e888
y.create.l HWIO_CRYPTO0_CRYPTO_AUTH_PIPE1_KEY3_ADDR A:0x73e88c
y.create.l HWIO_CRYPTO0_CRYPTO_AUTH_PIPE2_KEY0_ADDR A:0x73e900
y.create.l HWIO_CRYPTO0_CRYPTO_AUTH_PIPE2_KEY1_ADDR A:0x73e904
y.create.l HWIO_CRYPTO0_CRYPTO_AUTH_PIPE2_KEY2_ADDR A:0x73e908
y.create.l HWIO_CRYPTO0_CRYPTO_AUTH_PIPE2_KEY3_ADDR A:0x73e90c
y.create.l HWIO_CRYPTO0_CRYPTO_AUTH_PIPE3_KEY0_ADDR A:0x73e980
y.create.l HWIO_CRYPTO0_CRYPTO_AUTH_PIPE3_KEY1_ADDR A:0x73e984
y.create.l HWIO_CRYPTO0_CRYPTO_AUTH_PIPE3_KEY2_ADDR A:0x73e988
y.create.l HWIO_CRYPTO0_CRYPTO_AUTH_PIPE3_KEY3_ADDR A:0x73e98c
y.create.l HWIO_CRYPTO0_CRYPTO_AUTH_IV0_ADDR A:0x73a310
y.create.l HWIO_CRYPTO0_CRYPTO_AUTH_IV1_ADDR A:0x73a314
y.create.l HWIO_CRYPTO0_CRYPTO_AUTH_IV2_ADDR A:0x73a318
y.create.l HWIO_CRYPTO0_CRYPTO_AUTH_IV3_ADDR A:0x73a31c
y.create.l HWIO_CRYPTO0_CRYPTO_AUTH_IV4_ADDR A:0x73a320
y.create.l HWIO_CRYPTO0_CRYPTO_AUTH_IV5_ADDR A:0x73a324
y.create.l HWIO_CRYPTO0_CRYPTO_AUTH_IV6_ADDR A:0x73a328
y.create.l HWIO_CRYPTO0_CRYPTO_AUTH_IV7_ADDR A:0x73a32c
y.create.l HWIO_CRYPTO0_CRYPTO_AUTH_INFO_NONCE0_ADDR A:0x73a350
y.create.l HWIO_CRYPTO0_CRYPTO_AUTH_INFO_NONCE1_ADDR A:0x73a354
y.create.l HWIO_CRYPTO0_CRYPTO_AUTH_INFO_NONCE2_ADDR A:0x73a358
y.create.l HWIO_CRYPTO0_CRYPTO_AUTH_INFO_NONCE3_ADDR A:0x73a35c
y.create.l HWIO_CRYPTO0_CRYPTO_AUTH_BYTECNT0_ADDR A:0x73a390
y.create.l HWIO_CRYPTO0_CRYPTO_AUTH_BYTECNT1_ADDR A:0x73a394
y.create.l HWIO_CRYPTO0_CRYPTO_AUTH_EXP_MAC0_ADDR A:0x73a3a0
y.create.l HWIO_CRYPTO0_CRYPTO_AUTH_EXP_MAC1_ADDR A:0x73a3a4
y.create.l HWIO_CRYPTO0_CRYPTO_AUTH_EXP_MAC2_ADDR A:0x73a3a8
y.create.l HWIO_CRYPTO0_CRYPTO_AUTH_EXP_MAC3_ADDR A:0x73a3ac
y.create.l HWIO_CRYPTO0_CRYPTO_AUTH_EXP_MAC4_ADDR A:0x73a3b0
y.create.l HWIO_CRYPTO0_CRYPTO_AUTH_EXP_MAC5_ADDR A:0x73a3b4
y.create.l HWIO_CRYPTO0_CRYPTO_AUTH_EXP_MAC6_ADDR A:0x73a3b8
y.create.l HWIO_CRYPTO0_CRYPTO_AUTH_EXP_MAC7_ADDR A:0x73a3bc
y.create.l HWIO_CRYPTO0_CRYPTO_CONFIG_ADDR A:0x73a400
y.create.l HWIO_CRYPTO0_CRYPTO_DEBUG_ENABLE_ADDR A:0x73f000
y.create.l HWIO_CRYPTO0_CRYPTO_DEBUG_ADDR A:0x73f004
y.create.l HWIO_CRYPTO0_CRYPTO_PWR_CTRL_ADDR A:0x73f008
y.create.l HWIO_CRYPTO0_CRYPTO_BAM_CTRL_ADDR A:0x704000
y.create.l HWIO_CRYPTO0_CRYPTO_BAM_TIMER_ADDR A:0x704040
y.create.l HWIO_CRYPTO0_CRYPTO_BAM_TIMER_CTRL_ADDR A:0x704044
y.create.l HWIO_CRYPTO0_CRYPTO_BAM_DESC_CNT_TRSHLD_ADDR A:0x704008
y.create.l HWIO_CRYPTO0_CRYPTO_BAM_IRQ_STTS_ADDR A:0x704014
y.create.l HWIO_CRYPTO0_CRYPTO_BAM_IRQ_CLR_ADDR A:0x704018
y.create.l HWIO_CRYPTO0_CRYPTO_BAM_IRQ_EN_ADDR A:0x70401c
y.create.l HWIO_CRYPTO0_CRYPTO_BAM_CNFG_BITS_ADDR A:0x70407c
y.create.l HWIO_CRYPTO0_CRYPTO_BAM_REVISION_ADDR A:0x705000
y.create.l HWIO_CRYPTO0_CRYPTO_BAM_SW_VERSION_ADDR A:0x705004
y.create.l HWIO_CRYPTO0_CRYPTO_BAM_NUM_PIPES_ADDR A:0x705008
y.create.l HWIO_CRYPTO0_CRYPTO_BAM_TEST_BUS_SEL_ADDR A:0x705010
y.create.l HWIO_CRYPTO0_CRYPTO_BAM_TEST_BUS_REG_ADDR A:0x705014
y.create.l HWIO_CRYPTO0_CRYPTO_BAM_AHB_MASTER_ERR_CTRLS_ADDR A:0x705024
y.create.l HWIO_CRYPTO0_CRYPTO_BAM_AHB_MASTER_ERR_ADDR_ADDR A:0x705028
y.create.l HWIO_CRYPTO0_CRYPTO_BAM_AHB_MASTER_ERR_DATA_ADDR A:0x70502c
y.create.l HWIO_CRYPTO0_CRYPTO_BAM_AHB_MASTER_ERR_ADDR_LSB_ADDR A:0x705100
y.create.l HWIO_CRYPTO0_CRYPTO_BAM_AHB_MASTER_ERR_ADDR_MSB_ADDR A:0x705104
y.create.l HWIO_CRYPTO0_CRYPTO_BAM_TRUST_REG_ADDR A:0x706000
y.create.l HWIO_CRYPTO0_CRYPTO_BAM_P_TRUST_REG0_ADDR A:0x706020
y.create.l HWIO_CRYPTO0_CRYPTO_BAM_P_TRUST_REG1_ADDR A:0x706024
y.create.l HWIO_CRYPTO0_CRYPTO_BAM_P_TRUST_REG2_ADDR A:0x706028
y.create.l HWIO_CRYPTO0_CRYPTO_BAM_P_TRUST_REG3_ADDR A:0x70602c
y.create.l HWIO_CRYPTO0_CRYPTO_BAM_P_TRUST_REG4_ADDR A:0x706030
y.create.l HWIO_CRYPTO0_CRYPTO_BAM_P_TRUST_REG5_ADDR A:0x706034
y.create.l HWIO_CRYPTO0_CRYPTO_BAM_P_TRUST_REG6_ADDR A:0x706038
y.create.l HWIO_CRYPTO0_CRYPTO_BAM_P_TRUST_REG7_ADDR A:0x70603c
y.create.l HWIO_CRYPTO0_CRYPTO_BAM_IRQ_SRCS_EE0_ADDR A:0x707000
y.create.l HWIO_CRYPTO0_CRYPTO_BAM_IRQ_SRCS_EE1_ADDR A:0x708000
y.create.l HWIO_CRYPTO0_CRYPTO_BAM_IRQ_SRCS_EE2_ADDR A:0x709000
y.create.l HWIO_CRYPTO0_CRYPTO_BAM_IRQ_SRCS_EE3_ADDR A:0x70a000
y.create.l HWIO_CRYPTO0_CRYPTO_BAM_IRQ_SRCS_EE4_ADDR A:0x70b000
y.create.l HWIO_CRYPTO0_CRYPTO_BAM_IRQ_SRCS_EE5_ADDR A:0x70c000
y.create.l HWIO_CRYPTO0_CRYPTO_BAM_IRQ_SRCS_EE6_ADDR A:0x70d000
y.create.l HWIO_CRYPTO0_CRYPTO_BAM_IRQ_SRCS_EE7_ADDR A:0x70e000
y.create.l HWIO_CRYPTO0_CRYPTO_BAM_IRQ_SRCS_MSK_EE0_ADDR A:0x707004
y.create.l HWIO_CRYPTO0_CRYPTO_BAM_IRQ_SRCS_MSK_EE1_ADDR A:0x708004
y.create.l HWIO_CRYPTO0_CRYPTO_BAM_IRQ_SRCS_MSK_EE2_ADDR A:0x709004
y.create.l HWIO_CRYPTO0_CRYPTO_BAM_IRQ_SRCS_MSK_EE3_ADDR A:0x70a004
y.create.l HWIO_CRYPTO0_CRYPTO_BAM_IRQ_SRCS_MSK_EE4_ADDR A:0x70b004
y.create.l HWIO_CRYPTO0_CRYPTO_BAM_IRQ_SRCS_MSK_EE5_ADDR A:0x70c004
y.create.l HWIO_CRYPTO0_CRYPTO_BAM_IRQ_SRCS_MSK_EE6_ADDR A:0x70d004
y.create.l HWIO_CRYPTO0_CRYPTO_BAM_IRQ_SRCS_MSK_EE7_ADDR A:0x70e004
y.create.l HWIO_CRYPTO0_CRYPTO_BAM_IRQ_SRCS_UNMASKED_EE0_ADDR A:0x707008
y.create.l HWIO_CRYPTO0_CRYPTO_BAM_IRQ_SRCS_UNMASKED_EE1_ADDR A:0x708008
y.create.l HWIO_CRYPTO0_CRYPTO_BAM_IRQ_SRCS_UNMASKED_EE2_ADDR A:0x709008
y.create.l HWIO_CRYPTO0_CRYPTO_BAM_IRQ_SRCS_UNMASKED_EE3_ADDR A:0x70a008
y.create.l HWIO_CRYPTO0_CRYPTO_BAM_IRQ_SRCS_UNMASKED_EE4_ADDR A:0x70b008
y.create.l HWIO_CRYPTO0_CRYPTO_BAM_IRQ_SRCS_UNMASKED_EE5_ADDR A:0x70c008
y.create.l HWIO_CRYPTO0_CRYPTO_BAM_IRQ_SRCS_UNMASKED_EE6_ADDR A:0x70d008
y.create.l HWIO_CRYPTO0_CRYPTO_BAM_IRQ_SRCS_UNMASKED_EE7_ADDR A:0x70e008
y.create.l HWIO_CRYPTO0_CRYPTO_BAM_PIPE_ATTR_EE0_ADDR A:0x70700c
y.create.l HWIO_CRYPTO0_CRYPTO_BAM_PIPE_ATTR_EE1_ADDR A:0x70800c
y.create.l HWIO_CRYPTO0_CRYPTO_BAM_PIPE_ATTR_EE2_ADDR A:0x70900c
y.create.l HWIO_CRYPTO0_CRYPTO_BAM_PIPE_ATTR_EE3_ADDR A:0x70a00c
y.create.l HWIO_CRYPTO0_CRYPTO_BAM_PIPE_ATTR_EE4_ADDR A:0x70b00c
y.create.l HWIO_CRYPTO0_CRYPTO_BAM_PIPE_ATTR_EE5_ADDR A:0x70c00c
y.create.l HWIO_CRYPTO0_CRYPTO_BAM_PIPE_ATTR_EE6_ADDR A:0x70d00c
y.create.l HWIO_CRYPTO0_CRYPTO_BAM_PIPE_ATTR_EE7_ADDR A:0x70e00c
y.create.l HWIO_CRYPTO0_CRYPTO_BAM_IRQ_SRCS_ADDR A:0x707010
y.create.l HWIO_CRYPTO0_CRYPTO_BAM_IRQ_SRCS_MSK_ADDR A:0x707014
y.create.l HWIO_CRYPTO0_CRYPTO_BAM_IRQ_SRCS_UNMASKED_ADDR A:0x707018
y.create.l HWIO_CRYPTO0_CRYPTO_BAM_P_CTRL0_ADDR A:0x717000
y.create.l HWIO_CRYPTO0_CRYPTO_BAM_P_CTRL1_ADDR A:0x718000
y.create.l HWIO_CRYPTO0_CRYPTO_BAM_P_CTRL2_ADDR A:0x719000
y.create.l HWIO_CRYPTO0_CRYPTO_BAM_P_CTRL3_ADDR A:0x71a000
y.create.l HWIO_CRYPTO0_CRYPTO_BAM_P_CTRL4_ADDR A:0x71b000
y.create.l HWIO_CRYPTO0_CRYPTO_BAM_P_CTRL5_ADDR A:0x71c000
y.create.l HWIO_CRYPTO0_CRYPTO_BAM_P_CTRL6_ADDR A:0x71d000
y.create.l HWIO_CRYPTO0_CRYPTO_BAM_P_CTRL7_ADDR A:0x71e000
y.create.l HWIO_CRYPTO0_CRYPTO_BAM_P_RST0_ADDR A:0x717004
y.create.l HWIO_CRYPTO0_CRYPTO_BAM_P_RST1_ADDR A:0x718004
y.create.l HWIO_CRYPTO0_CRYPTO_BAM_P_RST2_ADDR A:0x719004
y.create.l HWIO_CRYPTO0_CRYPTO_BAM_P_RST3_ADDR A:0x71a004
y.create.l HWIO_CRYPTO0_CRYPTO_BAM_P_RST4_ADDR A:0x71b004
y.create.l HWIO_CRYPTO0_CRYPTO_BAM_P_RST5_ADDR A:0x71c004
y.create.l HWIO_CRYPTO0_CRYPTO_BAM_P_RST6_ADDR A:0x71d004
y.create.l HWIO_CRYPTO0_CRYPTO_BAM_P_RST7_ADDR A:0x71e004
y.create.l HWIO_CRYPTO0_CRYPTO_BAM_P_HALT0_ADDR A:0x717008
y.create.l HWIO_CRYPTO0_CRYPTO_BAM_P_HALT1_ADDR A:0x718008
y.create.l HWIO_CRYPTO0_CRYPTO_BAM_P_HALT2_ADDR A:0x719008
y.create.l HWIO_CRYPTO0_CRYPTO_BAM_P_HALT3_ADDR A:0x71a008
y.create.l HWIO_CRYPTO0_CRYPTO_BAM_P_HALT4_ADDR A:0x71b008
y.create.l HWIO_CRYPTO0_CRYPTO_BAM_P_HALT5_ADDR A:0x71c008
y.create.l HWIO_CRYPTO0_CRYPTO_BAM_P_HALT6_ADDR A:0x71d008
y.create.l HWIO_CRYPTO0_CRYPTO_BAM_P_HALT7_ADDR A:0x71e008
y.create.l HWIO_CRYPTO0_CRYPTO_BAM_P_IRQ_STTS0_ADDR A:0x717010
y.create.l HWIO_CRYPTO0_CRYPTO_BAM_P_IRQ_STTS1_ADDR A:0x718010
y.create.l HWIO_CRYPTO0_CRYPTO_BAM_P_IRQ_STTS2_ADDR A:0x719010
y.create.l HWIO_CRYPTO0_CRYPTO_BAM_P_IRQ_STTS3_ADDR A:0x71a010
y.create.l HWIO_CRYPTO0_CRYPTO_BAM_P_IRQ_STTS4_ADDR A:0x71b010
y.create.l HWIO_CRYPTO0_CRYPTO_BAM_P_IRQ_STTS5_ADDR A:0x71c010
y.create.l HWIO_CRYPTO0_CRYPTO_BAM_P_IRQ_STTS6_ADDR A:0x71d010
y.create.l HWIO_CRYPTO0_CRYPTO_BAM_P_IRQ_STTS7_ADDR A:0x71e010
y.create.l HWIO_CRYPTO0_CRYPTO_BAM_P_IRQ_CLR0_ADDR A:0x717014
y.create.l HWIO_CRYPTO0_CRYPTO_BAM_P_IRQ_CLR1_ADDR A:0x718014
y.create.l HWIO_CRYPTO0_CRYPTO_BAM_P_IRQ_CLR2_ADDR A:0x719014
y.create.l HWIO_CRYPTO0_CRYPTO_BAM_P_IRQ_CLR3_ADDR A:0x71a014
y.create.l HWIO_CRYPTO0_CRYPTO_BAM_P_IRQ_CLR4_ADDR A:0x71b014
y.create.l HWIO_CRYPTO0_CRYPTO_BAM_P_IRQ_CLR5_ADDR A:0x71c014
y.create.l HWIO_CRYPTO0_CRYPTO_BAM_P_IRQ_CLR6_ADDR A:0x71d014
y.create.l HWIO_CRYPTO0_CRYPTO_BAM_P_IRQ_CLR7_ADDR A:0x71e014
y.create.l HWIO_CRYPTO0_CRYPTO_BAM_P_IRQ_EN0_ADDR A:0x717018
y.create.l HWIO_CRYPTO0_CRYPTO_BAM_P_IRQ_EN1_ADDR A:0x718018
y.create.l HWIO_CRYPTO0_CRYPTO_BAM_P_IRQ_EN2_ADDR A:0x719018
y.create.l HWIO_CRYPTO0_CRYPTO_BAM_P_IRQ_EN3_ADDR A:0x71a018
y.create.l HWIO_CRYPTO0_CRYPTO_BAM_P_IRQ_EN4_ADDR A:0x71b018
y.create.l HWIO_CRYPTO0_CRYPTO_BAM_P_IRQ_EN5_ADDR A:0x71c018
y.create.l HWIO_CRYPTO0_CRYPTO_BAM_P_IRQ_EN6_ADDR A:0x71d018
y.create.l HWIO_CRYPTO0_CRYPTO_BAM_P_IRQ_EN7_ADDR A:0x71e018
y.create.l HWIO_CRYPTO0_CRYPTO_BAM_P_TIMER0_ADDR A:0x71701c
y.create.l HWIO_CRYPTO0_CRYPTO_BAM_P_TIMER1_ADDR A:0x71801c
y.create.l HWIO_CRYPTO0_CRYPTO_BAM_P_TIMER2_ADDR A:0x71901c
y.create.l HWIO_CRYPTO0_CRYPTO_BAM_P_TIMER3_ADDR A:0x71a01c
y.create.l HWIO_CRYPTO0_CRYPTO_BAM_P_TIMER4_ADDR A:0x71b01c
y.create.l HWIO_CRYPTO0_CRYPTO_BAM_P_TIMER5_ADDR A:0x71c01c
y.create.l HWIO_CRYPTO0_CRYPTO_BAM_P_TIMER6_ADDR A:0x71d01c
y.create.l HWIO_CRYPTO0_CRYPTO_BAM_P_TIMER7_ADDR A:0x71e01c
y.create.l HWIO_CRYPTO0_CRYPTO_BAM_P_TIMER_CTRL0_ADDR A:0x717020
y.create.l HWIO_CRYPTO0_CRYPTO_BAM_P_TIMER_CTRL1_ADDR A:0x718020
y.create.l HWIO_CRYPTO0_CRYPTO_BAM_P_TIMER_CTRL2_ADDR A:0x719020
y.create.l HWIO_CRYPTO0_CRYPTO_BAM_P_TIMER_CTRL3_ADDR A:0x71a020
y.create.l HWIO_CRYPTO0_CRYPTO_BAM_P_TIMER_CTRL4_ADDR A:0x71b020
y.create.l HWIO_CRYPTO0_CRYPTO_BAM_P_TIMER_CTRL5_ADDR A:0x71c020
y.create.l HWIO_CRYPTO0_CRYPTO_BAM_P_TIMER_CTRL6_ADDR A:0x71d020
y.create.l HWIO_CRYPTO0_CRYPTO_BAM_P_TIMER_CTRL7_ADDR A:0x71e020
y.create.l HWIO_CRYPTO0_CRYPTO_BAM_P_PRDCR_SDBND0_ADDR A:0x717024
y.create.l HWIO_CRYPTO0_CRYPTO_BAM_P_PRDCR_SDBND1_ADDR A:0x718024
y.create.l HWIO_CRYPTO0_CRYPTO_BAM_P_PRDCR_SDBND2_ADDR A:0x719024
y.create.l HWIO_CRYPTO0_CRYPTO_BAM_P_PRDCR_SDBND3_ADDR A:0x71a024
y.create.l HWIO_CRYPTO0_CRYPTO_BAM_P_PRDCR_SDBND4_ADDR A:0x71b024
y.create.l HWIO_CRYPTO0_CRYPTO_BAM_P_PRDCR_SDBND5_ADDR A:0x71c024
y.create.l HWIO_CRYPTO0_CRYPTO_BAM_P_PRDCR_SDBND6_ADDR A:0x71d024
y.create.l HWIO_CRYPTO0_CRYPTO_BAM_P_PRDCR_SDBND7_ADDR A:0x71e024
y.create.l HWIO_CRYPTO0_CRYPTO_BAM_P_CNSMR_SDBND0_ADDR A:0x717028
y.create.l HWIO_CRYPTO0_CRYPTO_BAM_P_CNSMR_SDBND1_ADDR A:0x718028
y.create.l HWIO_CRYPTO0_CRYPTO_BAM_P_CNSMR_SDBND2_ADDR A:0x719028
y.create.l HWIO_CRYPTO0_CRYPTO_BAM_P_CNSMR_SDBND3_ADDR A:0x71a028
y.create.l HWIO_CRYPTO0_CRYPTO_BAM_P_CNSMR_SDBND4_ADDR A:0x71b028
y.create.l HWIO_CRYPTO0_CRYPTO_BAM_P_CNSMR_SDBND5_ADDR A:0x71c028
y.create.l HWIO_CRYPTO0_CRYPTO_BAM_P_CNSMR_SDBND6_ADDR A:0x71d028
y.create.l HWIO_CRYPTO0_CRYPTO_BAM_P_CNSMR_SDBND7_ADDR A:0x71e028
y.create.l HWIO_CRYPTO0_CRYPTO_BAM_P_SW_OFSTS0_ADDR A:0x717800
y.create.l HWIO_CRYPTO0_CRYPTO_BAM_P_SW_OFSTS1_ADDR A:0x718800
y.create.l HWIO_CRYPTO0_CRYPTO_BAM_P_SW_OFSTS2_ADDR A:0x719800
y.create.l HWIO_CRYPTO0_CRYPTO_BAM_P_SW_OFSTS3_ADDR A:0x71a800
y.create.l HWIO_CRYPTO0_CRYPTO_BAM_P_SW_OFSTS4_ADDR A:0x71b800
y.create.l HWIO_CRYPTO0_CRYPTO_BAM_P_SW_OFSTS5_ADDR A:0x71c800
y.create.l HWIO_CRYPTO0_CRYPTO_BAM_P_SW_OFSTS6_ADDR A:0x71d800
y.create.l HWIO_CRYPTO0_CRYPTO_BAM_P_SW_OFSTS7_ADDR A:0x71e800
y.create.l HWIO_CRYPTO0_CRYPTO_BAM_P_AU_PSM_CNTXT_1_0_ADDR A:0x717804
y.create.l HWIO_CRYPTO0_CRYPTO_BAM_P_AU_PSM_CNTXT_1_1_ADDR A:0x718804
y.create.l HWIO_CRYPTO0_CRYPTO_BAM_P_AU_PSM_CNTXT_1_2_ADDR A:0x719804
y.create.l HWIO_CRYPTO0_CRYPTO_BAM_P_AU_PSM_CNTXT_1_3_ADDR A:0x71a804
y.create.l HWIO_CRYPTO0_CRYPTO_BAM_P_AU_PSM_CNTXT_1_4_ADDR A:0x71b804
y.create.l HWIO_CRYPTO0_CRYPTO_BAM_P_AU_PSM_CNTXT_1_5_ADDR A:0x71c804
y.create.l HWIO_CRYPTO0_CRYPTO_BAM_P_AU_PSM_CNTXT_1_6_ADDR A:0x71d804
y.create.l HWIO_CRYPTO0_CRYPTO_BAM_P_AU_PSM_CNTXT_1_7_ADDR A:0x71e804
y.create.l HWIO_CRYPTO0_CRYPTO_BAM_P_PSM_CNTXT_2_0_ADDR A:0x717808
y.create.l HWIO_CRYPTO0_CRYPTO_BAM_P_PSM_CNTXT_2_1_ADDR A:0x718808
y.create.l HWIO_CRYPTO0_CRYPTO_BAM_P_PSM_CNTXT_2_2_ADDR A:0x719808
y.create.l HWIO_CRYPTO0_CRYPTO_BAM_P_PSM_CNTXT_2_3_ADDR A:0x71a808
y.create.l HWIO_CRYPTO0_CRYPTO_BAM_P_PSM_CNTXT_2_4_ADDR A:0x71b808
y.create.l HWIO_CRYPTO0_CRYPTO_BAM_P_PSM_CNTXT_2_5_ADDR A:0x71c808
y.create.l HWIO_CRYPTO0_CRYPTO_BAM_P_PSM_CNTXT_2_6_ADDR A:0x71d808
y.create.l HWIO_CRYPTO0_CRYPTO_BAM_P_PSM_CNTXT_2_7_ADDR A:0x71e808
y.create.l HWIO_CRYPTO0_CRYPTO_BAM_P_PSM_CNTXT_3_0_ADDR A:0x71780c
y.create.l HWIO_CRYPTO0_CRYPTO_BAM_P_PSM_CNTXT_3_1_ADDR A:0x71880c
y.create.l HWIO_CRYPTO0_CRYPTO_BAM_P_PSM_CNTXT_3_2_ADDR A:0x71980c
y.create.l HWIO_CRYPTO0_CRYPTO_BAM_P_PSM_CNTXT_3_3_ADDR A:0x71a80c
y.create.l HWIO_CRYPTO0_CRYPTO_BAM_P_PSM_CNTXT_3_4_ADDR A:0x71b80c
y.create.l HWIO_CRYPTO0_CRYPTO_BAM_P_PSM_CNTXT_3_5_ADDR A:0x71c80c
y.create.l HWIO_CRYPTO0_CRYPTO_BAM_P_PSM_CNTXT_3_6_ADDR A:0x71d80c
y.create.l HWIO_CRYPTO0_CRYPTO_BAM_P_PSM_CNTXT_3_7_ADDR A:0x71e80c
y.create.l HWIO_CRYPTO0_CRYPTO_BAM_P_PSM_CNTXT_4_0_ADDR A:0x717810
y.create.l HWIO_CRYPTO0_CRYPTO_BAM_P_PSM_CNTXT_4_1_ADDR A:0x718810
y.create.l HWIO_CRYPTO0_CRYPTO_BAM_P_PSM_CNTXT_4_2_ADDR A:0x719810
y.create.l HWIO_CRYPTO0_CRYPTO_BAM_P_PSM_CNTXT_4_3_ADDR A:0x71a810
y.create.l HWIO_CRYPTO0_CRYPTO_BAM_P_PSM_CNTXT_4_4_ADDR A:0x71b810
y.create.l HWIO_CRYPTO0_CRYPTO_BAM_P_PSM_CNTXT_4_5_ADDR A:0x71c810
y.create.l HWIO_CRYPTO0_CRYPTO_BAM_P_PSM_CNTXT_4_6_ADDR A:0x71d810
y.create.l HWIO_CRYPTO0_CRYPTO_BAM_P_PSM_CNTXT_4_7_ADDR A:0x71e810
y.create.l HWIO_CRYPTO0_CRYPTO_BAM_P_PSM_CNTXT_5_0_ADDR A:0x717814
y.create.l HWIO_CRYPTO0_CRYPTO_BAM_P_PSM_CNTXT_5_1_ADDR A:0x718814
y.create.l HWIO_CRYPTO0_CRYPTO_BAM_P_PSM_CNTXT_5_2_ADDR A:0x719814
y.create.l HWIO_CRYPTO0_CRYPTO_BAM_P_PSM_CNTXT_5_3_ADDR A:0x71a814
y.create.l HWIO_CRYPTO0_CRYPTO_BAM_P_PSM_CNTXT_5_4_ADDR A:0x71b814
y.create.l HWIO_CRYPTO0_CRYPTO_BAM_P_PSM_CNTXT_5_5_ADDR A:0x71c814
y.create.l HWIO_CRYPTO0_CRYPTO_BAM_P_PSM_CNTXT_5_6_ADDR A:0x71d814
y.create.l HWIO_CRYPTO0_CRYPTO_BAM_P_PSM_CNTXT_5_7_ADDR A:0x71e814
y.create.l HWIO_CRYPTO0_CRYPTO_BAM_P_EVNT_REG0_ADDR A:0x717818
y.create.l HWIO_CRYPTO0_CRYPTO_BAM_P_EVNT_REG1_ADDR A:0x718818
y.create.l HWIO_CRYPTO0_CRYPTO_BAM_P_EVNT_REG2_ADDR A:0x719818
y.create.l HWIO_CRYPTO0_CRYPTO_BAM_P_EVNT_REG3_ADDR A:0x71a818
y.create.l HWIO_CRYPTO0_CRYPTO_BAM_P_EVNT_REG4_ADDR A:0x71b818
y.create.l HWIO_CRYPTO0_CRYPTO_BAM_P_EVNT_REG5_ADDR A:0x71c818
y.create.l HWIO_CRYPTO0_CRYPTO_BAM_P_EVNT_REG6_ADDR A:0x71d818
y.create.l HWIO_CRYPTO0_CRYPTO_BAM_P_EVNT_REG7_ADDR A:0x71e818
y.create.l HWIO_CRYPTO0_CRYPTO_BAM_P_DESC_FIFO_ADDR0_ADDR A:0x71781c
y.create.l HWIO_CRYPTO0_CRYPTO_BAM_P_DESC_FIFO_ADDR1_ADDR A:0x71881c
y.create.l HWIO_CRYPTO0_CRYPTO_BAM_P_DESC_FIFO_ADDR2_ADDR A:0x71981c
y.create.l HWIO_CRYPTO0_CRYPTO_BAM_P_DESC_FIFO_ADDR3_ADDR A:0x71a81c
y.create.l HWIO_CRYPTO0_CRYPTO_BAM_P_DESC_FIFO_ADDR4_ADDR A:0x71b81c
y.create.l HWIO_CRYPTO0_CRYPTO_BAM_P_DESC_FIFO_ADDR5_ADDR A:0x71c81c
y.create.l HWIO_CRYPTO0_CRYPTO_BAM_P_DESC_FIFO_ADDR6_ADDR A:0x71d81c
y.create.l HWIO_CRYPTO0_CRYPTO_BAM_P_DESC_FIFO_ADDR7_ADDR A:0x71e81c
y.create.l HWIO_CRYPTO0_CRYPTO_BAM_P_FIFO_SIZES0_ADDR A:0x717820
y.create.l HWIO_CRYPTO0_CRYPTO_BAM_P_FIFO_SIZES1_ADDR A:0x718820
y.create.l HWIO_CRYPTO0_CRYPTO_BAM_P_FIFO_SIZES2_ADDR A:0x719820
y.create.l HWIO_CRYPTO0_CRYPTO_BAM_P_FIFO_SIZES3_ADDR A:0x71a820
y.create.l HWIO_CRYPTO0_CRYPTO_BAM_P_FIFO_SIZES4_ADDR A:0x71b820
y.create.l HWIO_CRYPTO0_CRYPTO_BAM_P_FIFO_SIZES5_ADDR A:0x71c820
y.create.l HWIO_CRYPTO0_CRYPTO_BAM_P_FIFO_SIZES6_ADDR A:0x71d820
y.create.l HWIO_CRYPTO0_CRYPTO_BAM_P_FIFO_SIZES7_ADDR A:0x71e820
y.create.l HWIO_CRYPTO0_CRYPTO_BAM_P_DATA_FIFO_ADDR0_ADDR A:0x717824
y.create.l HWIO_CRYPTO0_CRYPTO_BAM_P_DATA_FIFO_ADDR1_ADDR A:0x718824
y.create.l HWIO_CRYPTO0_CRYPTO_BAM_P_DATA_FIFO_ADDR2_ADDR A:0x719824
y.create.l HWIO_CRYPTO0_CRYPTO_BAM_P_DATA_FIFO_ADDR3_ADDR A:0x71a824
y.create.l HWIO_CRYPTO0_CRYPTO_BAM_P_DATA_FIFO_ADDR4_ADDR A:0x71b824
y.create.l HWIO_CRYPTO0_CRYPTO_BAM_P_DATA_FIFO_ADDR5_ADDR A:0x71c824
y.create.l HWIO_CRYPTO0_CRYPTO_BAM_P_DATA_FIFO_ADDR6_ADDR A:0x71d824
y.create.l HWIO_CRYPTO0_CRYPTO_BAM_P_DATA_FIFO_ADDR7_ADDR A:0x71e824
y.create.l HWIO_CRYPTO0_CRYPTO_BAM_P_EVNT_GEN_TRSHLD0_ADDR A:0x717828
y.create.l HWIO_CRYPTO0_CRYPTO_BAM_P_EVNT_GEN_TRSHLD1_ADDR A:0x718828
y.create.l HWIO_CRYPTO0_CRYPTO_BAM_P_EVNT_GEN_TRSHLD2_ADDR A:0x719828
y.create.l HWIO_CRYPTO0_CRYPTO_BAM_P_EVNT_GEN_TRSHLD3_ADDR A:0x71a828
y.create.l HWIO_CRYPTO0_CRYPTO_BAM_P_EVNT_GEN_TRSHLD4_ADDR A:0x71b828
y.create.l HWIO_CRYPTO0_CRYPTO_BAM_P_EVNT_GEN_TRSHLD5_ADDR A:0x71c828
y.create.l HWIO_CRYPTO0_CRYPTO_BAM_P_EVNT_GEN_TRSHLD6_ADDR A:0x71d828
y.create.l HWIO_CRYPTO0_CRYPTO_BAM_P_EVNT_GEN_TRSHLD7_ADDR A:0x71e828
y.create.l HWIO_CRYPTO0_CRYPTO_BAM_P_EVNT_DEST_ADDR0_ADDR A:0x71782c
y.create.l HWIO_CRYPTO0_CRYPTO_BAM_P_EVNT_DEST_ADDR1_ADDR A:0x71882c
y.create.l HWIO_CRYPTO0_CRYPTO_BAM_P_EVNT_DEST_ADDR2_ADDR A:0x71982c
y.create.l HWIO_CRYPTO0_CRYPTO_BAM_P_EVNT_DEST_ADDR3_ADDR A:0x71a82c
y.create.l HWIO_CRYPTO0_CRYPTO_BAM_P_EVNT_DEST_ADDR4_ADDR A:0x71b82c
y.create.l HWIO_CRYPTO0_CRYPTO_BAM_P_EVNT_DEST_ADDR5_ADDR A:0x71c82c
y.create.l HWIO_CRYPTO0_CRYPTO_BAM_P_EVNT_DEST_ADDR6_ADDR A:0x71d82c
y.create.l HWIO_CRYPTO0_CRYPTO_BAM_P_EVNT_DEST_ADDR7_ADDR A:0x71e82c
y.create.l HWIO_CRYPTO0_CRYPTO_BAM_P_DF_CNTXT_0_ADDR A:0x717830
y.create.l HWIO_CRYPTO0_CRYPTO_BAM_P_DF_CNTXT_1_ADDR A:0x718830
y.create.l HWIO_CRYPTO0_CRYPTO_BAM_P_DF_CNTXT_2_ADDR A:0x719830
y.create.l HWIO_CRYPTO0_CRYPTO_BAM_P_DF_CNTXT_3_ADDR A:0x71a830
y.create.l HWIO_CRYPTO0_CRYPTO_BAM_P_DF_CNTXT_4_ADDR A:0x71b830
y.create.l HWIO_CRYPTO0_CRYPTO_BAM_P_DF_CNTXT_5_ADDR A:0x71c830
y.create.l HWIO_CRYPTO0_CRYPTO_BAM_P_DF_CNTXT_6_ADDR A:0x71d830
y.create.l HWIO_CRYPTO0_CRYPTO_BAM_P_DF_CNTXT_7_ADDR A:0x71e830
y.create.l HWIO_CRYPTO0_CRYPTO_BAM_P_RETR_CNTXT_0_ADDR A:0x717834
y.create.l HWIO_CRYPTO0_CRYPTO_BAM_P_RETR_CNTXT_1_ADDR A:0x718834
y.create.l HWIO_CRYPTO0_CRYPTO_BAM_P_RETR_CNTXT_2_ADDR A:0x719834
y.create.l HWIO_CRYPTO0_CRYPTO_BAM_P_RETR_CNTXT_3_ADDR A:0x71a834
y.create.l HWIO_CRYPTO0_CRYPTO_BAM_P_RETR_CNTXT_4_ADDR A:0x71b834
y.create.l HWIO_CRYPTO0_CRYPTO_BAM_P_RETR_CNTXT_5_ADDR A:0x71c834
y.create.l HWIO_CRYPTO0_CRYPTO_BAM_P_RETR_CNTXT_6_ADDR A:0x71d834
y.create.l HWIO_CRYPTO0_CRYPTO_BAM_P_RETR_CNTXT_7_ADDR A:0x71e834
y.create.l HWIO_CRYPTO0_CRYPTO_BAM_P_SI_CNTXT_0_ADDR A:0x717838
y.create.l HWIO_CRYPTO0_CRYPTO_BAM_P_SI_CNTXT_1_ADDR A:0x718838
y.create.l HWIO_CRYPTO0_CRYPTO_BAM_P_SI_CNTXT_2_ADDR A:0x719838
y.create.l HWIO_CRYPTO0_CRYPTO_BAM_P_SI_CNTXT_3_ADDR A:0x71a838
y.create.l HWIO_CRYPTO0_CRYPTO_BAM_P_SI_CNTXT_4_ADDR A:0x71b838
y.create.l HWIO_CRYPTO0_CRYPTO_BAM_P_SI_CNTXT_5_ADDR A:0x71c838
y.create.l HWIO_CRYPTO0_CRYPTO_BAM_P_SI_CNTXT_6_ADDR A:0x71d838
y.create.l HWIO_CRYPTO0_CRYPTO_BAM_P_SI_CNTXT_7_ADDR A:0x71e838
y.create.l HWIO_CRYPTO0_CRYPTO_BAM_P_PSM_CNTXT_3_LSB0_ADDR A:0x717900
y.create.l HWIO_CRYPTO0_CRYPTO_BAM_P_PSM_CNTXT_3_LSB1_ADDR A:0x718900
y.create.l HWIO_CRYPTO0_CRYPTO_BAM_P_PSM_CNTXT_3_LSB2_ADDR A:0x719900
y.create.l HWIO_CRYPTO0_CRYPTO_BAM_P_PSM_CNTXT_3_LSB3_ADDR A:0x71a900
y.create.l HWIO_CRYPTO0_CRYPTO_BAM_P_PSM_CNTXT_3_LSB4_ADDR A:0x71b900
y.create.l HWIO_CRYPTO0_CRYPTO_BAM_P_PSM_CNTXT_3_LSB5_ADDR A:0x71c900
y.create.l HWIO_CRYPTO0_CRYPTO_BAM_P_PSM_CNTXT_3_LSB6_ADDR A:0x71d900
y.create.l HWIO_CRYPTO0_CRYPTO_BAM_P_PSM_CNTXT_3_LSB7_ADDR A:0x71e900
y.create.l HWIO_CRYPTO0_CRYPTO_BAM_P_PSM_CNTXT_3_MSB0_ADDR A:0x717904
y.create.l HWIO_CRYPTO0_CRYPTO_BAM_P_PSM_CNTXT_3_MSB1_ADDR A:0x718904
y.create.l HWIO_CRYPTO0_CRYPTO_BAM_P_PSM_CNTXT_3_MSB2_ADDR A:0x719904
y.create.l HWIO_CRYPTO0_CRYPTO_BAM_P_PSM_CNTXT_3_MSB3_ADDR A:0x71a904
y.create.l HWIO_CRYPTO0_CRYPTO_BAM_P_PSM_CNTXT_3_MSB4_ADDR A:0x71b904
y.create.l HWIO_CRYPTO0_CRYPTO_BAM_P_PSM_CNTXT_3_MSB5_ADDR A:0x71c904
y.create.l HWIO_CRYPTO0_CRYPTO_BAM_P_PSM_CNTXT_3_MSB6_ADDR A:0x71d904
y.create.l HWIO_CRYPTO0_CRYPTO_BAM_P_PSM_CNTXT_3_MSB7_ADDR A:0x71e904
y.create.l HWIO_CRYPTO0_CRYPTO_BAM_P_DESC_FIFO_ADDR_LSB0_ADDR A:0x717910
y.create.l HWIO_CRYPTO0_CRYPTO_BAM_P_DESC_FIFO_ADDR_LSB1_ADDR A:0x718910
y.create.l HWIO_CRYPTO0_CRYPTO_BAM_P_DESC_FIFO_ADDR_LSB2_ADDR A:0x719910
y.create.l HWIO_CRYPTO0_CRYPTO_BAM_P_DESC_FIFO_ADDR_LSB3_ADDR A:0x71a910
y.create.l HWIO_CRYPTO0_CRYPTO_BAM_P_DESC_FIFO_ADDR_LSB4_ADDR A:0x71b910
y.create.l HWIO_CRYPTO0_CRYPTO_BAM_P_DESC_FIFO_ADDR_LSB5_ADDR A:0x71c910
y.create.l HWIO_CRYPTO0_CRYPTO_BAM_P_DESC_FIFO_ADDR_LSB6_ADDR A:0x71d910
y.create.l HWIO_CRYPTO0_CRYPTO_BAM_P_DESC_FIFO_ADDR_LSB7_ADDR A:0x71e910
y.create.l HWIO_CRYPTO0_CRYPTO_BAM_P_DESC_FIFO_ADDR_MSB0_ADDR A:0x717914
y.create.l HWIO_CRYPTO0_CRYPTO_BAM_P_DESC_FIFO_ADDR_MSB1_ADDR A:0x718914
y.create.l HWIO_CRYPTO0_CRYPTO_BAM_P_DESC_FIFO_ADDR_MSB2_ADDR A:0x719914
y.create.l HWIO_CRYPTO0_CRYPTO_BAM_P_DESC_FIFO_ADDR_MSB3_ADDR A:0x71a914
y.create.l HWIO_CRYPTO0_CRYPTO_BAM_P_DESC_FIFO_ADDR_MSB4_ADDR A:0x71b914
y.create.l HWIO_CRYPTO0_CRYPTO_BAM_P_DESC_FIFO_ADDR_MSB5_ADDR A:0x71c914
y.create.l HWIO_CRYPTO0_CRYPTO_BAM_P_DESC_FIFO_ADDR_MSB6_ADDR A:0x71d914
y.create.l HWIO_CRYPTO0_CRYPTO_BAM_P_DESC_FIFO_ADDR_MSB7_ADDR A:0x71e914
y.create.l HWIO_CRYPTO0_CRYPTO_BAM_P_DATA_FIFO_ADDR_LSB0_ADDR A:0x717920
y.create.l HWIO_CRYPTO0_CRYPTO_BAM_P_DATA_FIFO_ADDR_LSB1_ADDR A:0x718920
y.create.l HWIO_CRYPTO0_CRYPTO_BAM_P_DATA_FIFO_ADDR_LSB2_ADDR A:0x719920
y.create.l HWIO_CRYPTO0_CRYPTO_BAM_P_DATA_FIFO_ADDR_LSB3_ADDR A:0x71a920
y.create.l HWIO_CRYPTO0_CRYPTO_BAM_P_DATA_FIFO_ADDR_LSB4_ADDR A:0x71b920
y.create.l HWIO_CRYPTO0_CRYPTO_BAM_P_DATA_FIFO_ADDR_LSB5_ADDR A:0x71c920
y.create.l HWIO_CRYPTO0_CRYPTO_BAM_P_DATA_FIFO_ADDR_LSB6_ADDR A:0x71d920
y.create.l HWIO_CRYPTO0_CRYPTO_BAM_P_DATA_FIFO_ADDR_LSB7_ADDR A:0x71e920
y.create.l HWIO_CRYPTO0_CRYPTO_BAM_P_DATA_FIFO_ADDR_MSB0_ADDR A:0x717924
y.create.l HWIO_CRYPTO0_CRYPTO_BAM_P_DATA_FIFO_ADDR_MSB1_ADDR A:0x718924
y.create.l HWIO_CRYPTO0_CRYPTO_BAM_P_DATA_FIFO_ADDR_MSB2_ADDR A:0x719924
y.create.l HWIO_CRYPTO0_CRYPTO_BAM_P_DATA_FIFO_ADDR_MSB3_ADDR A:0x71a924
y.create.l HWIO_CRYPTO0_CRYPTO_BAM_P_DATA_FIFO_ADDR_MSB4_ADDR A:0x71b924
y.create.l HWIO_CRYPTO0_CRYPTO_BAM_P_DATA_FIFO_ADDR_MSB5_ADDR A:0x71c924
y.create.l HWIO_CRYPTO0_CRYPTO_BAM_P_DATA_FIFO_ADDR_MSB6_ADDR A:0x71d924
y.create.l HWIO_CRYPTO0_CRYPTO_BAM_P_DATA_FIFO_ADDR_MSB7_ADDR A:0x71e924
y.create.l HWIO_CRYPTO0_CRYPTO_BAM_P_EVNT_DEST_ADDR_LSB0_ADDR A:0x717930
y.create.l HWIO_CRYPTO0_CRYPTO_BAM_P_EVNT_DEST_ADDR_LSB1_ADDR A:0x718930
y.create.l HWIO_CRYPTO0_CRYPTO_BAM_P_EVNT_DEST_ADDR_LSB2_ADDR A:0x719930
y.create.l HWIO_CRYPTO0_CRYPTO_BAM_P_EVNT_DEST_ADDR_LSB3_ADDR A:0x71a930
y.create.l HWIO_CRYPTO0_CRYPTO_BAM_P_EVNT_DEST_ADDR_LSB4_ADDR A:0x71b930
y.create.l HWIO_CRYPTO0_CRYPTO_BAM_P_EVNT_DEST_ADDR_LSB5_ADDR A:0x71c930
y.create.l HWIO_CRYPTO0_CRYPTO_BAM_P_EVNT_DEST_ADDR_LSB6_ADDR A:0x71d930
y.create.l HWIO_CRYPTO0_CRYPTO_BAM_P_EVNT_DEST_ADDR_LSB7_ADDR A:0x71e930
y.create.l HWIO_CRYPTO0_CRYPTO_BAM_P_EVNT_DEST_ADDR_MSB0_ADDR A:0x717934
y.create.l HWIO_CRYPTO0_CRYPTO_BAM_P_EVNT_DEST_ADDR_MSB1_ADDR A:0x718934
y.create.l HWIO_CRYPTO0_CRYPTO_BAM_P_EVNT_DEST_ADDR_MSB2_ADDR A:0x719934
y.create.l HWIO_CRYPTO0_CRYPTO_BAM_P_EVNT_DEST_ADDR_MSB3_ADDR A:0x71a934
y.create.l HWIO_CRYPTO0_CRYPTO_BAM_P_EVNT_DEST_ADDR_MSB4_ADDR A:0x71b934
y.create.l HWIO_CRYPTO0_CRYPTO_BAM_P_EVNT_DEST_ADDR_MSB5_ADDR A:0x71c934
y.create.l HWIO_CRYPTO0_CRYPTO_BAM_P_EVNT_DEST_ADDR_MSB6_ADDR A:0x71d934
y.create.l HWIO_CRYPTO0_CRYPTO_BAM_P_EVNT_DEST_ADDR_MSB7_ADDR A:0x71e934
y.create.l HWIO_CRYPTO0_CRYPTO_BAM_XPU_SCR_ADDR A:0x702000
y.create.l HWIO_CRYPTO0_CRYPTO_BAM_XPU_SWDR_ADDR A:0x702004
y.create.l HWIO_CRYPTO0_CRYPTO_BAM_XPU_SEAR0_ADDR A:0x702040
y.create.l HWIO_CRYPTO0_CRYPTO_BAM_XPU_SESR_ADDR A:0x702048
y.create.l HWIO_CRYPTO0_CRYPTO_BAM_XPU_SESRRESTORE_ADDR A:0x70204c
y.create.l HWIO_CRYPTO0_CRYPTO_BAM_XPU_SESYNR0_ADDR A:0x702050
y.create.l HWIO_CRYPTO0_CRYPTO_BAM_XPU_SESYNR1_ADDR A:0x702054
y.create.l HWIO_CRYPTO0_CRYPTO_BAM_XPU_SESYNR2_ADDR A:0x702058
y.create.l HWIO_CRYPTO0_CRYPTO_BAM_XPU_MCR_ADDR A:0x702100
y.create.l HWIO_CRYPTO0_CRYPTO_BAM_XPU_MEAR0_ADDR A:0x702140
y.create.l HWIO_CRYPTO0_CRYPTO_BAM_XPU_MESR_ADDR A:0x702148
y.create.l HWIO_CRYPTO0_CRYPTO_BAM_XPU_MESRRESTORE_ADDR A:0x70214c
y.create.l HWIO_CRYPTO0_CRYPTO_BAM_XPU_MESYNR0_ADDR A:0x702150
y.create.l HWIO_CRYPTO0_CRYPTO_BAM_XPU_MESYNR1_ADDR A:0x702154
y.create.l HWIO_CRYPTO0_CRYPTO_BAM_XPU_MESYNR2_ADDR A:0x702158
y.create.l HWIO_CRYPTO0_CRYPTO_BAM_XPU_CR_ADDR A:0x702080
y.create.l HWIO_CRYPTO0_CRYPTO_BAM_XPU_RPU_ACR0_ADDR A:0x7020a0
y.create.l HWIO_CRYPTO0_CRYPTO_BAM_XPU_EAR0_ADDR A:0x7020c0
y.create.l HWIO_CRYPTO0_CRYPTO_BAM_XPU_ESR_ADDR A:0x7020c8
y.create.l HWIO_CRYPTO0_CRYPTO_BAM_XPU_ESRRESTORE_ADDR A:0x7020cc
y.create.l HWIO_CRYPTO0_CRYPTO_BAM_XPU_ESYNR0_ADDR A:0x7020d0
y.create.l HWIO_CRYPTO0_CRYPTO_BAM_XPU_ESYNR1_ADDR A:0x7020d4
y.create.l HWIO_CRYPTO0_CRYPTO_BAM_XPU_ESYNR2_ADDR A:0x7020d8
y.create.l HWIO_CRYPTO0_CRYPTO_BAM_XPU_IDR0_ADDR A:0x702074
y.create.l HWIO_CRYPTO0_CRYPTO_BAM_XPU_IDR1_ADDR A:0x702078
y.create.l HWIO_CRYPTO0_CRYPTO_BAM_XPU_REV_ADDR A:0x70207c
y.create.l HWIO_CRYPTO0_CRYPTO_BAM_XPU_RG0_RACR0_ADDR A:0x702200
y.create.l HWIO_CRYPTO0_CRYPTO_BAM_XPU_RG1_RACR0_ADDR A:0x702280
y.create.l HWIO_CRYPTO0_CRYPTO_BAM_XPU_RG2_RACR0_ADDR A:0x702300
y.create.l HWIO_CRYPTO0_CRYPTO_BAM_XPU_RG3_RACR0_ADDR A:0x702380
y.create.l HWIO_CRYPTO0_CRYPTO_BAM_XPU_RG4_RACR0_ADDR A:0x702400
y.create.l HWIO_CRYPTO0_CRYPTO_BAM_XPU_RG5_RACR0_ADDR A:0x702480
y.create.l HWIO_CRYPTO0_CRYPTO_BAM_XPU_RG6_RACR0_ADDR A:0x702500
y.create.l HWIO_CRYPTO0_CRYPTO_BAM_XPU_RG7_RACR0_ADDR A:0x702580
y.create.l HWIO_CRYPTO0_CRYPTO_BAM_XPU_RG8_RACR0_ADDR A:0x702600
y.create.l HWIO_CRYPTO0_CRYPTO_BAM_XPU_RG9_RACR0_ADDR A:0x702680
y.create.l HWIO_CRYPTO0_CRYPTO_BAM_XPU_RG0_SCR_ADDR A:0x702250
y.create.l HWIO_CRYPTO0_CRYPTO_BAM_XPU_RG1_SCR_ADDR A:0x7022d0
y.create.l HWIO_CRYPTO0_CRYPTO_BAM_XPU_RG2_SCR_ADDR A:0x702350
y.create.l HWIO_CRYPTO0_CRYPTO_BAM_XPU_RG3_SCR_ADDR A:0x7023d0
y.create.l HWIO_CRYPTO0_CRYPTO_BAM_XPU_RG4_SCR_ADDR A:0x702450
y.create.l HWIO_CRYPTO0_CRYPTO_BAM_XPU_RG5_SCR_ADDR A:0x7024d0
y.create.l HWIO_CRYPTO0_CRYPTO_BAM_XPU_RG6_SCR_ADDR A:0x702550
y.create.l HWIO_CRYPTO0_CRYPTO_BAM_XPU_RG7_SCR_ADDR A:0x7025d0
y.create.l HWIO_CRYPTO0_CRYPTO_BAM_XPU_RG8_SCR_ADDR A:0x702650
y.create.l HWIO_CRYPTO0_CRYPTO_BAM_XPU_RG9_SCR_ADDR A:0x7026d0
y.create.l HWIO_CRYPTO0_CRYPTO_BAM_XPU_RG0_MCR_ADDR A:0x702254
y.create.l HWIO_CRYPTO0_CRYPTO_BAM_XPU_RG1_MCR_ADDR A:0x7022d4
y.create.l HWIO_CRYPTO0_CRYPTO_BAM_XPU_RG2_MCR_ADDR A:0x702354
y.create.l HWIO_CRYPTO0_CRYPTO_BAM_XPU_RG3_MCR_ADDR A:0x7023d4
y.create.l HWIO_CRYPTO0_CRYPTO_BAM_XPU_RG4_MCR_ADDR A:0x702454
y.create.l HWIO_CRYPTO0_CRYPTO_BAM_XPU_RG5_MCR_ADDR A:0x7024d4
y.create.l HWIO_CRYPTO0_CRYPTO_BAM_XPU_RG6_MCR_ADDR A:0x702554
y.create.l HWIO_CRYPTO0_CRYPTO_BAM_XPU_RG7_MCR_ADDR A:0x7025d4
y.create.l HWIO_CRYPTO0_CRYPTO_BAM_XPU_RG8_MCR_ADDR A:0x702654
y.create.l HWIO_CRYPTO0_CRYPTO_BAM_XPU_RG9_MCR_ADDR A:0x7026d4
y.create.l HWIO_CRYPTO0_CRYPTO_BAM_VMIDMT_SCR0_ADDR A:0x700000
y.create.l HWIO_CRYPTO0_CRYPTO_BAM_VMIDMT_SCR1_ADDR A:0x700004
y.create.l HWIO_CRYPTO0_CRYPTO_BAM_VMIDMT_SCR2_ADDR A:0x700008
y.create.l HWIO_CRYPTO0_CRYPTO_BAM_VMIDMT_SACR_ADDR A:0x700010
y.create.l HWIO_CRYPTO0_CRYPTO_BAM_VMIDMT_SIDR0_ADDR A:0x700020
y.create.l HWIO_CRYPTO0_CRYPTO_BAM_VMIDMT_SIDR1_ADDR A:0x700024
y.create.l HWIO_CRYPTO0_CRYPTO_BAM_VMIDMT_SIDR2_ADDR A:0x700028
y.create.l HWIO_CRYPTO0_CRYPTO_BAM_VMIDMT_SIDR4_ADDR A:0x700030
y.create.l HWIO_CRYPTO0_CRYPTO_BAM_VMIDMT_SIDR5_ADDR A:0x700034
y.create.l HWIO_CRYPTO0_CRYPTO_BAM_VMIDMT_SIDR7_ADDR A:0x70003c
y.create.l HWIO_CRYPTO0_CRYPTO_BAM_VMIDMT_SGFAR0_ADDR A:0x700040
y.create.l HWIO_CRYPTO0_CRYPTO_BAM_VMIDMT_SGFSR_ADDR A:0x700048
y.create.l HWIO_CRYPTO0_CRYPTO_BAM_VMIDMT_SGFSRRESTORE_ADDR A:0x70004c
y.create.l HWIO_CRYPTO0_CRYPTO_BAM_VMIDMT_SGFSYNDR0_ADDR A:0x700050
y.create.l HWIO_CRYPTO0_CRYPTO_BAM_VMIDMT_SGFSYNDR1_ADDR A:0x700054
y.create.l HWIO_CRYPTO0_CRYPTO_BAM_VMIDMT_SGFSYNDR2_ADDR A:0x700058
y.create.l HWIO_CRYPTO0_CRYPTO_BAM_VMIDMT_VMIDMTSCR0_ADDR A:0x700090
y.create.l HWIO_CRYPTO0_CRYPTO_BAM_VMIDMT_CR0_ADDR A:0x700000
y.create.l HWIO_CRYPTO0_CRYPTO_BAM_VMIDMT_CR2_ADDR A:0x700008
y.create.l HWIO_CRYPTO0_CRYPTO_BAM_VMIDMT_ACR_ADDR A:0x700010
y.create.l HWIO_CRYPTO0_CRYPTO_BAM_VMIDMT_IDR0_ADDR A:0x700020
y.create.l HWIO_CRYPTO0_CRYPTO_BAM_VMIDMT_IDR1_ADDR A:0x700024
y.create.l HWIO_CRYPTO0_CRYPTO_BAM_VMIDMT_IDR2_ADDR A:0x700028
y.create.l HWIO_CRYPTO0_CRYPTO_BAM_VMIDMT_IDR4_ADDR A:0x700030
y.create.l HWIO_CRYPTO0_CRYPTO_BAM_VMIDMT_IDR5_ADDR A:0x700034
y.create.l HWIO_CRYPTO0_CRYPTO_BAM_VMIDMT_IDR7_ADDR A:0x70003c
y.create.l HWIO_CRYPTO0_CRYPTO_BAM_VMIDMT_GFAR0_ADDR A:0x700040
y.create.l HWIO_CRYPTO0_CRYPTO_BAM_VMIDMT_GFSR_ADDR A:0x700048
y.create.l HWIO_CRYPTO0_CRYPTO_BAM_VMIDMT_GFSRRESTORE_ADDR A:0x70004c
y.create.l HWIO_CRYPTO0_CRYPTO_BAM_VMIDMT_GFSYNDR0_ADDR A:0x700050
y.create.l HWIO_CRYPTO0_CRYPTO_BAM_VMIDMT_GFSYNDR1_ADDR A:0x700054
y.create.l HWIO_CRYPTO0_CRYPTO_BAM_VMIDMT_GFSYNDR2_ADDR A:0x700058
y.create.l HWIO_CRYPTO0_CRYPTO_BAM_VMIDMT_VMIDMTCR0_ADDR A:0x700090
y.create.l HWIO_CRYPTO0_CRYPTO_BAM_VMIDMT_VMIDMTACR_ADDR A:0x70009c
y.create.l HWIO_CRYPTO0_CRYPTO_BAM_VMIDMT_NSCR0_ADDR A:0x700400
y.create.l HWIO_CRYPTO0_CRYPTO_BAM_VMIDMT_NSCR2_ADDR A:0x700408
y.create.l HWIO_CRYPTO0_CRYPTO_BAM_VMIDMT_NSACR_ADDR A:0x700410
y.create.l HWIO_CRYPTO0_CRYPTO_BAM_VMIDMT_NSGFAR0_ADDR A:0x700440
y.create.l HWIO_CRYPTO0_CRYPTO_BAM_VMIDMT_NSGFSR_ADDR A:0x700448
y.create.l HWIO_CRYPTO0_CRYPTO_BAM_VMIDMT_NSGFSRRESTORE_ADDR A:0x70044c
y.create.l HWIO_CRYPTO0_CRYPTO_BAM_VMIDMT_NSGFSYNDR0_ADDR A:0x700450
y.create.l HWIO_CRYPTO0_CRYPTO_BAM_VMIDMT_NSGFSYNDR1_ADDR A:0x700454
y.create.l HWIO_CRYPTO0_CRYPTO_BAM_VMIDMT_NSGFSYNDR2_ADDR A:0x700458
y.create.l HWIO_CRYPTO0_CRYPTO_BAM_VMIDMT_NSVMIDMTCR0_ADDR A:0x700490
y.create.l HWIO_CRYPTO0_CRYPTO_BAM_VMIDMT_SSDR0_ADDR A:0x700080
y.create.l HWIO_CRYPTO0_CRYPTO_BAM_VMIDMT_MSDR0_ADDR A:0x700480
y.create.l HWIO_CRYPTO0_CRYPTO_BAM_VMIDMT_MCR_ADDR A:0x700494
y.create.l HWIO_CRYPTO0_CRYPTO_BAM_VMIDMT_S2VR0_ADDR A:0x700c00
y.create.l HWIO_CRYPTO0_CRYPTO_BAM_VMIDMT_S2VR1_ADDR A:0x700c04
y.create.l HWIO_CRYPTO0_CRYPTO_BAM_VMIDMT_S2VR2_ADDR A:0x700c08
y.create.l HWIO_CRYPTO0_CRYPTO_BAM_VMIDMT_S2VR3_ADDR A:0x700c0c
y.create.l HWIO_CRYPTO0_CRYPTO_BAM_VMIDMT_S2VR4_ADDR A:0x700c10
y.create.l HWIO_CRYPTO0_CRYPTO_BAM_VMIDMT_S2VR5_ADDR A:0x700c14
y.create.l HWIO_CRYPTO0_CRYPTO_BAM_VMIDMT_S2VR6_ADDR A:0x700c18
y.create.l HWIO_CRYPTO0_CRYPTO_BAM_VMIDMT_S2VR7_ADDR A:0x700c1c
y.create.l HWIO_CRYPTO0_CRYPTO_BAM_VMIDMT_S2VR8_ADDR A:0x700c20
y.create.l HWIO_CRYPTO0_CRYPTO_BAM_VMIDMT_AS2VR0_ADDR A:0x700e00
y.create.l HWIO_CRYPTO0_CRYPTO_BAM_VMIDMT_AS2VR1_ADDR A:0x700e04
y.create.l HWIO_CRYPTO0_CRYPTO_BAM_VMIDMT_AS2VR2_ADDR A:0x700e08
y.create.l HWIO_CRYPTO0_CRYPTO_BAM_VMIDMT_AS2VR3_ADDR A:0x700e0c
y.create.l HWIO_CRYPTO0_CRYPTO_BAM_VMIDMT_AS2VR4_ADDR A:0x700e10
y.create.l HWIO_CRYPTO0_CRYPTO_BAM_VMIDMT_AS2VR5_ADDR A:0x700e14
y.create.l HWIO_CRYPTO0_CRYPTO_BAM_VMIDMT_AS2VR6_ADDR A:0x700e18
y.create.l HWIO_CRYPTO0_CRYPTO_BAM_VMIDMT_AS2VR7_ADDR A:0x700e1c
y.create.l HWIO_CRYPTO0_CRYPTO_BAM_VMIDMT_AS2VR8_ADDR A:0x700e20
y.create.l HWIO_CRYPTO0_CRYPTO_BAM_VMIDMT_SMR0_ADDR A:0x700800
y.create.l HWIO_CRYPTO0_CRYPTO_BAM_VMIDMT_SMR1_ADDR A:0x700804
y.create.l HWIO_CRYPTO0_CRYPTO_BAM_VMIDMT_SMR2_ADDR A:0x700808
y.create.l HWIO_CRYPTO0_CRYPTO_BAM_VMIDMT_SMR3_ADDR A:0x70080c
y.create.l HWIO_CRYPTO0_CRYPTO_BAM_VMIDMT_SMR4_ADDR A:0x700810
y.create.l HWIO_CRYPTO0_CRYPTO_BAM_VMIDMT_SMR5_ADDR A:0x700814
y.create.l HWIO_CRYPTO0_CRYPTO_BAM_VMIDMT_SMR6_ADDR A:0x700818
y.create.l HWIO_CRYPTO0_CRYPTO_BAM_VMIDMT_SMR7_ADDR A:0x70081c
y.create.l HWIO_CRYPTO0_CRYPTO_BAM_VMIDMT_SMR8_ADDR A:0x700820
y.create.l HWIO_DEHR_BIMC_DEHR_HW_VERSION_ADDR A:0x4b2000
y.create.l HWIO_DEHR_BIMC_DEHR_HW_INFO_ADDR A:0x4b2004
y.create.l HWIO_DEHR_BIMC_DEHR_CGC_CFG_ADDR A:0x4b2010
y.create.l HWIO_DEHR_BIMC_DEHR_MSA_CFG_ADDR A:0x4b2104
y.create.l HWIO_DEHR_BIMC_DEHR_RAM_CFG_ADDR A:0x4b2140
y.create.l HWIO_DEHR_BIMC_DEHR_DMA_STATUS_ADDR A:0x4b2200
y.create.l HWIO_DEHR_BIMC_DEHR_DBG_CFG_ADDR A:0x4b2400
y.create.l HWIO_DEHR_BIMC_DEHR_SW_DMA_CFG_ADDR A:0x4b2404
y.create.l HWIO_DEHR_BIMC_DEHR_DBG_ADDR_ADDR A:0x4b2408
y.create.l HWIO_DEHR_BIMC_DEHR_SEC_CFG_ADDR A:0x4b3000
y.create.l HWIO_DEHR_XPU_SCR_ADDR A:0x4b0000
y.create.l HWIO_DEHR_XPU_SWDR_ADDR A:0x4b0004
y.create.l HWIO_DEHR_XPU_SEAR0_ADDR A:0x4b0040
y.create.l HWIO_DEHR_XPU_SESR_ADDR A:0x4b0048
y.create.l HWIO_DEHR_XPU_SESRRESTORE_ADDR A:0x4b004c
y.create.l HWIO_DEHR_XPU_SESYNR0_ADDR A:0x4b0050
y.create.l HWIO_DEHR_XPU_SESYNR1_ADDR A:0x4b0054
y.create.l HWIO_DEHR_XPU_SESYNR2_ADDR A:0x4b0058
y.create.l HWIO_DEHR_XPU_MCR_ADDR A:0x4b0100
y.create.l HWIO_DEHR_XPU_MEAR0_ADDR A:0x4b0140
y.create.l HWIO_DEHR_XPU_MESR_ADDR A:0x4b0148
y.create.l HWIO_DEHR_XPU_MESRRESTORE_ADDR A:0x4b014c
y.create.l HWIO_DEHR_XPU_MESYNR0_ADDR A:0x4b0150
y.create.l HWIO_DEHR_XPU_MESYNR1_ADDR A:0x4b0154
y.create.l HWIO_DEHR_XPU_MESYNR2_ADDR A:0x4b0158
y.create.l HWIO_DEHR_XPU_CR_ADDR A:0x4b0080
y.create.l HWIO_DEHR_XPU_RPU_ACR0_ADDR A:0x4b00a0
y.create.l HWIO_DEHR_XPU_EAR0_ADDR A:0x4b00c0
y.create.l HWIO_DEHR_XPU_ESR_ADDR A:0x4b00c8
y.create.l HWIO_DEHR_XPU_ESRRESTORE_ADDR A:0x4b00cc
y.create.l HWIO_DEHR_XPU_ESYNR0_ADDR A:0x4b00d0
y.create.l HWIO_DEHR_XPU_ESYNR1_ADDR A:0x4b00d4
y.create.l HWIO_DEHR_XPU_ESYNR2_ADDR A:0x4b00d8
y.create.l HWIO_DEHR_XPU_IDR0_ADDR A:0x4b0074
y.create.l HWIO_DEHR_XPU_IDR1_ADDR A:0x4b0078
y.create.l HWIO_DEHR_XPU_REV_ADDR A:0x4b007c
y.create.l HWIO_DEHR_XPU_RG0_RACR0_ADDR A:0x4b0200
y.create.l HWIO_DEHR_XPU_RG1_RACR0_ADDR A:0x4b0280
y.create.l HWIO_DEHR_XPU_RG0_SCR_ADDR A:0x4b0250
y.create.l HWIO_DEHR_XPU_RG1_SCR_ADDR A:0x4b02d0
y.create.l HWIO_DEHR_XPU_RG0_MCR_ADDR A:0x4b0254
y.create.l HWIO_DEHR_XPU_RG1_MCR_ADDR A:0x4b02d4
y.create.l HWIO_DEHR_VMIDMT_SCR0_ADDR A:0x4b1000
y.create.l HWIO_DEHR_VMIDMT_SCR1_ADDR A:0x4b1004
y.create.l HWIO_DEHR_VMIDMT_SCR2_ADDR A:0x4b1008
y.create.l HWIO_DEHR_VMIDMT_SACR_ADDR A:0x4b1010
y.create.l HWIO_DEHR_VMIDMT_SIDR0_ADDR A:0x4b1020
y.create.l HWIO_DEHR_VMIDMT_SIDR1_ADDR A:0x4b1024
y.create.l HWIO_DEHR_VMIDMT_SIDR2_ADDR A:0x4b1028
y.create.l HWIO_DEHR_VMIDMT_SIDR4_ADDR A:0x4b1030
y.create.l HWIO_DEHR_VMIDMT_SIDR5_ADDR A:0x4b1034
y.create.l HWIO_DEHR_VMIDMT_SIDR7_ADDR A:0x4b103c
y.create.l HWIO_DEHR_VMIDMT_SGFAR0_ADDR A:0x4b1040
y.create.l HWIO_DEHR_VMIDMT_SGFSR_ADDR A:0x4b1048
y.create.l HWIO_DEHR_VMIDMT_SGFSRRESTORE_ADDR A:0x4b104c
y.create.l HWIO_DEHR_VMIDMT_SGFSYNDR0_ADDR A:0x4b1050
y.create.l HWIO_DEHR_VMIDMT_SGFSYNDR1_ADDR A:0x4b1054
y.create.l HWIO_DEHR_VMIDMT_SGFSYNDR2_ADDR A:0x4b1058
y.create.l HWIO_DEHR_VMIDMT_VMIDMTSCR0_ADDR A:0x4b1090
y.create.l HWIO_DEHR_VMIDMT_CR0_ADDR A:0x4b1000
y.create.l HWIO_DEHR_VMIDMT_CR2_ADDR A:0x4b1008
y.create.l HWIO_DEHR_VMIDMT_ACR_ADDR A:0x4b1010
y.create.l HWIO_DEHR_VMIDMT_IDR0_ADDR A:0x4b1020
y.create.l HWIO_DEHR_VMIDMT_IDR1_ADDR A:0x4b1024
y.create.l HWIO_DEHR_VMIDMT_IDR2_ADDR A:0x4b1028
y.create.l HWIO_DEHR_VMIDMT_IDR4_ADDR A:0x4b1030
y.create.l HWIO_DEHR_VMIDMT_IDR5_ADDR A:0x4b1034
y.create.l HWIO_DEHR_VMIDMT_IDR7_ADDR A:0x4b103c
y.create.l HWIO_DEHR_VMIDMT_GFAR0_ADDR A:0x4b1040
y.create.l HWIO_DEHR_VMIDMT_GFSR_ADDR A:0x4b1048
y.create.l HWIO_DEHR_VMIDMT_GFSRRESTORE_ADDR A:0x4b104c
y.create.l HWIO_DEHR_VMIDMT_GFSYNDR0_ADDR A:0x4b1050
y.create.l HWIO_DEHR_VMIDMT_GFSYNDR1_ADDR A:0x4b1054
y.create.l HWIO_DEHR_VMIDMT_GFSYNDR2_ADDR A:0x4b1058
y.create.l HWIO_DEHR_VMIDMT_VMIDMTCR0_ADDR A:0x4b1090
y.create.l HWIO_DEHR_VMIDMT_VMIDMTACR_ADDR A:0x4b109c
y.create.l HWIO_DEHR_VMIDMT_NSCR0_ADDR A:0x4b1400
y.create.l HWIO_DEHR_VMIDMT_NSCR2_ADDR A:0x4b1408
y.create.l HWIO_DEHR_VMIDMT_NSACR_ADDR A:0x4b1410
y.create.l HWIO_DEHR_VMIDMT_NSGFAR0_ADDR A:0x4b1440
y.create.l HWIO_DEHR_VMIDMT_NSGFSR_ADDR A:0x4b1448
y.create.l HWIO_DEHR_VMIDMT_NSGFSRRESTORE_ADDR A:0x4b144c
y.create.l HWIO_DEHR_VMIDMT_NSGFSYNDR0_ADDR A:0x4b1450
y.create.l HWIO_DEHR_VMIDMT_NSGFSYNDR1_ADDR A:0x4b1454
y.create.l HWIO_DEHR_VMIDMT_NSGFSYNDR2_ADDR A:0x4b1458
y.create.l HWIO_DEHR_VMIDMT_NSVMIDMTCR0_ADDR A:0x4b1490
y.create.l HWIO_DEHR_VMIDMT_SSDR0_ADDR A:0x4b1080
y.create.l HWIO_DEHR_VMIDMT_MSDR0_ADDR A:0x4b1480
y.create.l HWIO_DEHR_VMIDMT_MCR_ADDR A:0x4b1494
y.create.l HWIO_DEHR_VMIDMT_S2VR0_ADDR A:0x4b1c00
y.create.l HWIO_DEHR_VMIDMT_AS2VR0_ADDR A:0x4b1e00
y.create.l HWIO_DIM_C00_DIM_CA_TOP_CFG_ADDR A:0x480000
y.create.l HWIO_DIM_C00_DIM_CA_HW_INFO_ADDR A:0x480004
y.create.l HWIO_DIM_C00_DIM_CA_HW_VERSION_ADDR A:0x480008
y.create.l HWIO_DIM_C00_DIM_CA_PAD_CFG0_ADDR A:0x480010
y.create.l HWIO_DIM_C00_DIM_CA_PAD_CFG1_ADDR A:0x480014
y.create.l HWIO_DIM_C00_DIM_CA_PAD_CFG2_ADDR A:0x480018
y.create.l HWIO_DIM_C00_DIM_CA_PAD_CFG3_ADDR A:0x48001c
y.create.l HWIO_DIM_C00_DIM_CA_PAD_CFG4_ADDR A:0x480020
y.create.l HWIO_DIM_C00_DDRPHY_CA_MISR_CFG_ADDR A:0x480024
y.create.l HWIO_DIM_C00_DDRPHY_CA_MISR_EVEN_STATUS_ADDR A:0x480028
y.create.l HWIO_DIM_C00_DDRPHY_CA_MISR_ODD_STATUS_ADDR A:0x48002c
y.create.l HWIO_DIM_C00_DIM_CA_CDC_CTLR_CFG0_ADDR A:0x480030
y.create.l HWIO_DIM_C00_DIM_CA_CDC_CTLR_CFG1_ADDR A:0x480034
y.create.l HWIO_DIM_C00_DIM_CA_CDC_CAL_TIMER_CFG0_ADDR A:0x480038
y.create.l HWIO_DIM_C00_DIM_CA_CDC_CAL_TIMER_CFG1_ADDR A:0x48003c
y.create.l HWIO_DIM_C00_DIM_CA_CDC_REFCOUNT_CFG_ADDR A:0x480040
y.create.l HWIO_DIM_C00_DIM_CA_CDC_COARSE_CAL_CFG_ADDR A:0x480044
y.create.l HWIO_DIM_C00_DIM_CA_CDC_RSVD_CFG_ADDR A:0x480048
y.create.l HWIO_DIM_C00_DIM_CA_CDC_OFFSET_CFG_ADDR A:0x48004c
y.create.l HWIO_DIM_C00_DIM_CA_CDC_DELAY_CFG_ADDR A:0x480050
y.create.l HWIO_DIM_C00_DIM_CA_CDC_SW_MODE_CFG_ADDR A:0x480054
y.create.l HWIO_DIM_C00_DIM_CA_CDC_TEST_CFG_ADDR A:0x480058
y.create.l HWIO_DIM_C00_DIM_CA_CDC_SW_OVRD_CFG_ADDR A:0x48005c
y.create.l HWIO_DIM_C00_DIM_CA_CDC_STATUS0_ADDR A:0x480070
y.create.l HWIO_DIM_C00_DIM_CA_CDC_STATUS1_ADDR A:0x480074
y.create.l HWIO_DIM_C00_DIM_CA_CDC_STATUS2_ADDR A:0x480078
y.create.l HWIO_DIM_C00_DIM_CA_CDC_STATUS3_ADDR A:0x48007c
y.create.l HWIO_DIM_C00_DIM_CA_IOC_CTLR_CFG_ADDR A:0x4800e0
y.create.l HWIO_DIM_C00_DIM_CA_IOC_CTLR_PNCNT_CFG_ADDR A:0x4800e4
y.create.l HWIO_DIM_C00_DIM_CA_IOC_CTLR_TIMER_CFG_ADDR A:0x4800e8
y.create.l HWIO_DIM_C00_DIM_CA_IOC_CTLR_TIMER_STATUS_ADDR A:0x4800ec
y.create.l HWIO_DIM_C00_DIM_CA_IOC_CTLR_CHAR_CFG_ADDR A:0x4800f0
y.create.l HWIO_DIM_C00_DIM_CA_IOC_CTLR_STATUS_ADDR A:0x4800f4
y.create.l HWIO_DIM_C00_DIM_CA_CA_IOC_SLV_CFG_ADDR A:0x480100
y.create.l HWIO_DIM_C00_DIM_CA_CA_IOC_SLV_STATUS_ADDR A:0x480104
y.create.l HWIO_DIM_C00_DIM_CA_CK_IOC_SLV_CFG_ADDR A:0x480110
y.create.l HWIO_DIM_C00_DIM_CA_CK_IOC_SLV_STATUS_ADDR A:0x480114
y.create.l HWIO_DIM_D00_DIM_DQ_TOP_CFG_ADDR A:0x480800
y.create.l HWIO_DIM_D00_DIM_DQ_HW_INFO_ADDR A:0x480804
y.create.l HWIO_DIM_D00_DIM_DQ_HW_VERSION_ADDR A:0x480808
y.create.l HWIO_DIM_D00_DIM_DQ_PAD_CFG0_ADDR A:0x480810
y.create.l HWIO_DIM_D00_DIM_DQ_PAD_CFG1_ADDR A:0x480814
y.create.l HWIO_DIM_D00_DIM_DQ_PAD_CFG2_ADDR A:0x480818
y.create.l HWIO_DIM_D00_DIM_DQ_DQ_SMT_STATUS_ADDR A:0x48081c
y.create.l HWIO_DIM_D00_DIM_DQ_PAD_CFG3_ADDR A:0x480820
y.create.l HWIO_DIM_D00_DIM_DQ_PAD_CFG4_ADDR A:0x480824
y.create.l HWIO_DIM_D00_DDRPHY_DQ_MISR_CFG_ADDR A:0x48080c
y.create.l HWIO_DIM_D00_DDRPHY_DQ_MISR_EVEN_STATUS_ADDR A:0x480828
y.create.l HWIO_DIM_D00_DDRPHY_DQ_MISR_ODD_STATUS_ADDR A:0x48082c
y.create.l HWIO_DIM_D00_DIM_DQ_CDC_CTLR_CFG0_ADDR A:0x480830
y.create.l HWIO_DIM_D00_DIM_DQ_CDC_CTLR_CFG1_ADDR A:0x480834
y.create.l HWIO_DIM_D00_DIM_DQ_CDC_CAL_TIMER_CFG0_ADDR A:0x480838
y.create.l HWIO_DIM_D00_DIM_DQ_CDC_CAL_TIMER_CFG1_ADDR A:0x48083c
y.create.l HWIO_DIM_D00_DIM_DQ_CDC_REFCOUNT_CFG_ADDR A:0x480840
y.create.l HWIO_DIM_D00_DIM_DQ_CDC_COARSE_CAL_CFG_ADDR A:0x480844
y.create.l HWIO_DIM_D00_DIM_DQ_CDC_RSVD_CFG_ADDR A:0x480848
y.create.l HWIO_DIM_D00_DIM_DQ_RD_CDC_OFFSET_CFG_ADDR A:0x48084c
y.create.l HWIO_DIM_D00_DIM_DQ_RD_CDC_DELAY_CFG_ADDR A:0x480850
y.create.l HWIO_DIM_D00_DIM_DQ_RD_CDC_SW_MODE_CFG_ADDR A:0x480854
y.create.l HWIO_DIM_D00_DIM_DQ_RD_CDC_TEST_CFG_ADDR A:0x480858
y.create.l HWIO_DIM_D00_DIM_DQ_RD_CDC_SW_OVRD_CFG_ADDR A:0x48085c
y.create.l HWIO_DIM_D00_DIM_DQ_RD_CDC_SLAVE_DDA_CFG_ADDR A:0x480860
y.create.l HWIO_DIM_D00_DIM_DQ_RD_CDC_STATUS0_ADDR A:0x480870
y.create.l HWIO_DIM_D00_DIM_DQ_RD_CDC_STATUS1_ADDR A:0x480874
y.create.l HWIO_DIM_D00_DIM_DQ_RD_CDC_STATUS2_ADDR A:0x480878
y.create.l HWIO_DIM_D00_DIM_DQ_RD_CDC_STATUS3_ADDR A:0x48087c
y.create.l HWIO_DIM_D00_DIM_DQ_RD_CDC_STATUS4_ADDR A:0x480880
y.create.l HWIO_DIM_D00_DIM_DQ_WR_CDC_OFFSET_CFG_ADDR A:0x4808ac
y.create.l HWIO_DIM_D00_DIM_DQ_WR_CDC_DELAY_CFG_ADDR A:0x4808b0
y.create.l HWIO_DIM_D00_DIM_DQ_WR_CDC_SW_MODE_CFG_ADDR A:0x4808b4
y.create.l HWIO_DIM_D00_DIM_DQ_WR_CDC_TEST_CFG_ADDR A:0x4808b8
y.create.l HWIO_DIM_D00_DIM_DQ_WR_CDC_SW_OVRD_CFG_ADDR A:0x4808bc
y.create.l HWIO_DIM_D00_DIM_DQ_WR_CDC_STATUS0_ADDR A:0x4808d0
y.create.l HWIO_DIM_D00_DIM_DQ_WR_CDC_STATUS1_ADDR A:0x4808d4
y.create.l HWIO_DIM_D00_DIM_DQ_WR_CDC_STATUS2_ADDR A:0x4808d8
y.create.l HWIO_DIM_D00_DIM_DQ_WR_CDC_STATUS3_ADDR A:0x4808dc
y.create.l HWIO_DIM_D00_DIM_DQ_DQ_IOC_SLV_CFG_ADDR A:0x480900
y.create.l HWIO_DIM_D00_DIM_DQ_DQ_IOC_SLV_STATUS_ADDR A:0x480904
y.create.l HWIO_DIM_D00_DIM_DQ_DQS_IOC_SLV_CFG_ADDR A:0x480910
y.create.l HWIO_DIM_D00_DIM_DQ_DQS_IOC_SLV_STATUS_ADDR A:0x480914
y.create.l HWIO_DIM_D01_DIM_DQ_TOP_CFG_ADDR A:0x481000
y.create.l HWIO_DIM_D01_DIM_DQ_HW_INFO_ADDR A:0x481004
y.create.l HWIO_DIM_D01_DIM_DQ_HW_VERSION_ADDR A:0x481008
y.create.l HWIO_DIM_D01_DIM_DQ_PAD_CFG0_ADDR A:0x481010
y.create.l HWIO_DIM_D01_DIM_DQ_PAD_CFG1_ADDR A:0x481014
y.create.l HWIO_DIM_D01_DIM_DQ_PAD_CFG2_ADDR A:0x481018
y.create.l HWIO_DIM_D01_DIM_DQ_DQ_SMT_STATUS_ADDR A:0x48101c
y.create.l HWIO_DIM_D01_DIM_DQ_PAD_CFG3_ADDR A:0x481020
y.create.l HWIO_DIM_D01_DIM_DQ_PAD_CFG4_ADDR A:0x481024
y.create.l HWIO_DIM_D01_DDRPHY_DQ_MISR_CFG_ADDR A:0x48100c
y.create.l HWIO_DIM_D01_DDRPHY_DQ_MISR_EVEN_STATUS_ADDR A:0x481028
y.create.l HWIO_DIM_D01_DDRPHY_DQ_MISR_ODD_STATUS_ADDR A:0x48102c
y.create.l HWIO_DIM_D01_DIM_DQ_CDC_CTLR_CFG0_ADDR A:0x481030
y.create.l HWIO_DIM_D01_DIM_DQ_CDC_CTLR_CFG1_ADDR A:0x481034
y.create.l HWIO_DIM_D01_DIM_DQ_CDC_CAL_TIMER_CFG0_ADDR A:0x481038
y.create.l HWIO_DIM_D01_DIM_DQ_CDC_CAL_TIMER_CFG1_ADDR A:0x48103c
y.create.l HWIO_DIM_D01_DIM_DQ_CDC_REFCOUNT_CFG_ADDR A:0x481040
y.create.l HWIO_DIM_D01_DIM_DQ_CDC_COARSE_CAL_CFG_ADDR A:0x481044
y.create.l HWIO_DIM_D01_DIM_DQ_CDC_RSVD_CFG_ADDR A:0x481048
y.create.l HWIO_DIM_D01_DIM_DQ_RD_CDC_OFFSET_CFG_ADDR A:0x48104c
y.create.l HWIO_DIM_D01_DIM_DQ_RD_CDC_DELAY_CFG_ADDR A:0x481050
y.create.l HWIO_DIM_D01_DIM_DQ_RD_CDC_SW_MODE_CFG_ADDR A:0x481054
y.create.l HWIO_DIM_D01_DIM_DQ_RD_CDC_TEST_CFG_ADDR A:0x481058
y.create.l HWIO_DIM_D01_DIM_DQ_RD_CDC_SW_OVRD_CFG_ADDR A:0x48105c
y.create.l HWIO_DIM_D01_DIM_DQ_RD_CDC_SLAVE_DDA_CFG_ADDR A:0x481060
y.create.l HWIO_DIM_D01_DIM_DQ_RD_CDC_STATUS0_ADDR A:0x481070
y.create.l HWIO_DIM_D01_DIM_DQ_RD_CDC_STATUS1_ADDR A:0x481074
y.create.l HWIO_DIM_D01_DIM_DQ_RD_CDC_STATUS2_ADDR A:0x481078
y.create.l HWIO_DIM_D01_DIM_DQ_RD_CDC_STATUS3_ADDR A:0x48107c
y.create.l HWIO_DIM_D01_DIM_DQ_RD_CDC_STATUS4_ADDR A:0x481080
y.create.l HWIO_DIM_D01_DIM_DQ_WR_CDC_OFFSET_CFG_ADDR A:0x4810ac
y.create.l HWIO_DIM_D01_DIM_DQ_WR_CDC_DELAY_CFG_ADDR A:0x4810b0
y.create.l HWIO_DIM_D01_DIM_DQ_WR_CDC_SW_MODE_CFG_ADDR A:0x4810b4
y.create.l HWIO_DIM_D01_DIM_DQ_WR_CDC_TEST_CFG_ADDR A:0x4810b8
y.create.l HWIO_DIM_D01_DIM_DQ_WR_CDC_SW_OVRD_CFG_ADDR A:0x4810bc
y.create.l HWIO_DIM_D01_DIM_DQ_WR_CDC_STATUS0_ADDR A:0x4810d0
y.create.l HWIO_DIM_D01_DIM_DQ_WR_CDC_STATUS1_ADDR A:0x4810d4
y.create.l HWIO_DIM_D01_DIM_DQ_WR_CDC_STATUS2_ADDR A:0x4810d8
y.create.l HWIO_DIM_D01_DIM_DQ_WR_CDC_STATUS3_ADDR A:0x4810dc
y.create.l HWIO_DIM_D01_DIM_DQ_DQ_IOC_SLV_CFG_ADDR A:0x481100
y.create.l HWIO_DIM_D01_DIM_DQ_DQ_IOC_SLV_STATUS_ADDR A:0x481104
y.create.l HWIO_DIM_D01_DIM_DQ_DQS_IOC_SLV_CFG_ADDR A:0x481110
y.create.l HWIO_DIM_D01_DIM_DQ_DQS_IOC_SLV_STATUS_ADDR A:0x481114
y.create.l HWIO_DIM_D02_DIM_DQ_TOP_CFG_ADDR A:0x481800
y.create.l HWIO_DIM_D02_DIM_DQ_HW_INFO_ADDR A:0x481804
y.create.l HWIO_DIM_D02_DIM_DQ_HW_VERSION_ADDR A:0x481808
y.create.l HWIO_DIM_D02_DIM_DQ_PAD_CFG0_ADDR A:0x481810
y.create.l HWIO_DIM_D02_DIM_DQ_PAD_CFG1_ADDR A:0x481814
y.create.l HWIO_DIM_D02_DIM_DQ_PAD_CFG2_ADDR A:0x481818
y.create.l HWIO_DIM_D02_DIM_DQ_DQ_SMT_STATUS_ADDR A:0x48181c
y.create.l HWIO_DIM_D02_DIM_DQ_PAD_CFG3_ADDR A:0x481820
y.create.l HWIO_DIM_D02_DIM_DQ_PAD_CFG4_ADDR A:0x481824
y.create.l HWIO_DIM_D02_DDRPHY_DQ_MISR_CFG_ADDR A:0x48180c
y.create.l HWIO_DIM_D02_DDRPHY_DQ_MISR_EVEN_STATUS_ADDR A:0x481828
y.create.l HWIO_DIM_D02_DDRPHY_DQ_MISR_ODD_STATUS_ADDR A:0x48182c
y.create.l HWIO_DIM_D02_DIM_DQ_CDC_CTLR_CFG0_ADDR A:0x481830
y.create.l HWIO_DIM_D02_DIM_DQ_CDC_CTLR_CFG1_ADDR A:0x481834
y.create.l HWIO_DIM_D02_DIM_DQ_CDC_CAL_TIMER_CFG0_ADDR A:0x481838
y.create.l HWIO_DIM_D02_DIM_DQ_CDC_CAL_TIMER_CFG1_ADDR A:0x48183c
y.create.l HWIO_DIM_D02_DIM_DQ_CDC_REFCOUNT_CFG_ADDR A:0x481840
y.create.l HWIO_DIM_D02_DIM_DQ_CDC_COARSE_CAL_CFG_ADDR A:0x481844
y.create.l HWIO_DIM_D02_DIM_DQ_CDC_RSVD_CFG_ADDR A:0x481848
y.create.l HWIO_DIM_D02_DIM_DQ_RD_CDC_OFFSET_CFG_ADDR A:0x48184c
y.create.l HWIO_DIM_D02_DIM_DQ_RD_CDC_DELAY_CFG_ADDR A:0x481850
y.create.l HWIO_DIM_D02_DIM_DQ_RD_CDC_SW_MODE_CFG_ADDR A:0x481854
y.create.l HWIO_DIM_D02_DIM_DQ_RD_CDC_TEST_CFG_ADDR A:0x481858
y.create.l HWIO_DIM_D02_DIM_DQ_RD_CDC_SW_OVRD_CFG_ADDR A:0x48185c
y.create.l HWIO_DIM_D02_DIM_DQ_RD_CDC_SLAVE_DDA_CFG_ADDR A:0x481860
y.create.l HWIO_DIM_D02_DIM_DQ_RD_CDC_STATUS0_ADDR A:0x481870
y.create.l HWIO_DIM_D02_DIM_DQ_RD_CDC_STATUS1_ADDR A:0x481874
y.create.l HWIO_DIM_D02_DIM_DQ_RD_CDC_STATUS2_ADDR A:0x481878
y.create.l HWIO_DIM_D02_DIM_DQ_RD_CDC_STATUS3_ADDR A:0x48187c
y.create.l HWIO_DIM_D02_DIM_DQ_RD_CDC_STATUS4_ADDR A:0x481880
y.create.l HWIO_DIM_D02_DIM_DQ_WR_CDC_OFFSET_CFG_ADDR A:0x4818ac
y.create.l HWIO_DIM_D02_DIM_DQ_WR_CDC_DELAY_CFG_ADDR A:0x4818b0
y.create.l HWIO_DIM_D02_DIM_DQ_WR_CDC_SW_MODE_CFG_ADDR A:0x4818b4
y.create.l HWIO_DIM_D02_DIM_DQ_WR_CDC_TEST_CFG_ADDR A:0x4818b8
y.create.l HWIO_DIM_D02_DIM_DQ_WR_CDC_SW_OVRD_CFG_ADDR A:0x4818bc
y.create.l HWIO_DIM_D02_DIM_DQ_WR_CDC_STATUS0_ADDR A:0x4818d0
y.create.l HWIO_DIM_D02_DIM_DQ_WR_CDC_STATUS1_ADDR A:0x4818d4
y.create.l HWIO_DIM_D02_DIM_DQ_WR_CDC_STATUS2_ADDR A:0x4818d8
y.create.l HWIO_DIM_D02_DIM_DQ_WR_CDC_STATUS3_ADDR A:0x4818dc
y.create.l HWIO_DIM_D02_DIM_DQ_DQ_IOC_SLV_CFG_ADDR A:0x481900
y.create.l HWIO_DIM_D02_DIM_DQ_DQ_IOC_SLV_STATUS_ADDR A:0x481904
y.create.l HWIO_DIM_D02_DIM_DQ_DQS_IOC_SLV_CFG_ADDR A:0x481910
y.create.l HWIO_DIM_D02_DIM_DQ_DQS_IOC_SLV_STATUS_ADDR A:0x481914
y.create.l HWIO_DIM_D03_DIM_DQ_TOP_CFG_ADDR A:0x482000
y.create.l HWIO_DIM_D03_DIM_DQ_HW_INFO_ADDR A:0x482004
y.create.l HWIO_DIM_D03_DIM_DQ_HW_VERSION_ADDR A:0x482008
y.create.l HWIO_DIM_D03_DIM_DQ_PAD_CFG0_ADDR A:0x482010
y.create.l HWIO_DIM_D03_DIM_DQ_PAD_CFG1_ADDR A:0x482014
y.create.l HWIO_DIM_D03_DIM_DQ_PAD_CFG2_ADDR A:0x482018
y.create.l HWIO_DIM_D03_DIM_DQ_DQ_SMT_STATUS_ADDR A:0x48201c
y.create.l HWIO_DIM_D03_DIM_DQ_PAD_CFG3_ADDR A:0x482020
y.create.l HWIO_DIM_D03_DIM_DQ_PAD_CFG4_ADDR A:0x482024
y.create.l HWIO_DIM_D03_DDRPHY_DQ_MISR_CFG_ADDR A:0x48200c
y.create.l HWIO_DIM_D03_DDRPHY_DQ_MISR_EVEN_STATUS_ADDR A:0x482028
y.create.l HWIO_DIM_D03_DDRPHY_DQ_MISR_ODD_STATUS_ADDR A:0x48202c
y.create.l HWIO_DIM_D03_DIM_DQ_CDC_CTLR_CFG0_ADDR A:0x482030
y.create.l HWIO_DIM_D03_DIM_DQ_CDC_CTLR_CFG1_ADDR A:0x482034
y.create.l HWIO_DIM_D03_DIM_DQ_CDC_CAL_TIMER_CFG0_ADDR A:0x482038
y.create.l HWIO_DIM_D03_DIM_DQ_CDC_CAL_TIMER_CFG1_ADDR A:0x48203c
y.create.l HWIO_DIM_D03_DIM_DQ_CDC_REFCOUNT_CFG_ADDR A:0x482040
y.create.l HWIO_DIM_D03_DIM_DQ_CDC_COARSE_CAL_CFG_ADDR A:0x482044
y.create.l HWIO_DIM_D03_DIM_DQ_CDC_RSVD_CFG_ADDR A:0x482048
y.create.l HWIO_DIM_D03_DIM_DQ_RD_CDC_OFFSET_CFG_ADDR A:0x48204c
y.create.l HWIO_DIM_D03_DIM_DQ_RD_CDC_DELAY_CFG_ADDR A:0x482050
y.create.l HWIO_DIM_D03_DIM_DQ_RD_CDC_SW_MODE_CFG_ADDR A:0x482054
y.create.l HWIO_DIM_D03_DIM_DQ_RD_CDC_TEST_CFG_ADDR A:0x482058
y.create.l HWIO_DIM_D03_DIM_DQ_RD_CDC_SW_OVRD_CFG_ADDR A:0x48205c
y.create.l HWIO_DIM_D03_DIM_DQ_RD_CDC_SLAVE_DDA_CFG_ADDR A:0x482060
y.create.l HWIO_DIM_D03_DIM_DQ_RD_CDC_STATUS0_ADDR A:0x482070
y.create.l HWIO_DIM_D03_DIM_DQ_RD_CDC_STATUS1_ADDR A:0x482074
y.create.l HWIO_DIM_D03_DIM_DQ_RD_CDC_STATUS2_ADDR A:0x482078
y.create.l HWIO_DIM_D03_DIM_DQ_RD_CDC_STATUS3_ADDR A:0x48207c
y.create.l HWIO_DIM_D03_DIM_DQ_RD_CDC_STATUS4_ADDR A:0x482080
y.create.l HWIO_DIM_D03_DIM_DQ_WR_CDC_OFFSET_CFG_ADDR A:0x4820ac
y.create.l HWIO_DIM_D03_DIM_DQ_WR_CDC_DELAY_CFG_ADDR A:0x4820b0
y.create.l HWIO_DIM_D03_DIM_DQ_WR_CDC_SW_MODE_CFG_ADDR A:0x4820b4
y.create.l HWIO_DIM_D03_DIM_DQ_WR_CDC_TEST_CFG_ADDR A:0x4820b8
y.create.l HWIO_DIM_D03_DIM_DQ_WR_CDC_SW_OVRD_CFG_ADDR A:0x4820bc
y.create.l HWIO_DIM_D03_DIM_DQ_WR_CDC_STATUS0_ADDR A:0x4820d0
y.create.l HWIO_DIM_D03_DIM_DQ_WR_CDC_STATUS1_ADDR A:0x4820d4
y.create.l HWIO_DIM_D03_DIM_DQ_WR_CDC_STATUS2_ADDR A:0x4820d8
y.create.l HWIO_DIM_D03_DIM_DQ_WR_CDC_STATUS3_ADDR A:0x4820dc
y.create.l HWIO_DIM_D03_DIM_DQ_DQ_IOC_SLV_CFG_ADDR A:0x482100
y.create.l HWIO_DIM_D03_DIM_DQ_DQ_IOC_SLV_STATUS_ADDR A:0x482104
y.create.l HWIO_DIM_D03_DIM_DQ_DQS_IOC_SLV_CFG_ADDR A:0x482110
y.create.l HWIO_DIM_D03_DIM_DQ_DQS_IOC_SLV_STATUS_ADDR A:0x482114
y.create.l HWIO_EBI1_HW_VERSION_ADDR A:0x49f000
y.create.l HWIO_EBI1_HW_INFO_ADDR A:0x49f004
y.create.l HWIO_EBI1_AHB2PHY_BROADCAST_EN_CFG_LOWER_ADDR A:0x49f008
y.create.l HWIO_EBI1_AHB2PHY_BROADCAST_EN_CFG_UPPER_ADDR A:0x49f00c
y.create.l HWIO_EBI1_AHB2PHY_TOP_CFG_ADDR A:0x49f010
y.create.l HWIO_EBI1_AHB2PHY_DEBUG_BUS_CFG_ADDR A:0x49f014
y.create.l HWIO_EBI1_AHB2PHY_BROADCAST_ADDRESS_SPACE_0_ADDR A:0x49f800
y.create.l HWIO_EBI1_AHB2PHY_BROADCAST_ADDRESS_SPACE_1_ADDR A:0x49f804
y.create.l HWIO_EBI1_AHB2PHY_BROADCAST_ADDRESS_SPACE_2_ADDR A:0x49f808
y.create.l HWIO_EBI1_AHB2PHY_BROADCAST_ADDRESS_SPACE_3_ADDR A:0x49f80c
y.create.l HWIO_EBI1_AHB2PHY_BROADCAST_ADDRESS_SPACE_4_ADDR A:0x49f810
y.create.l HWIO_EBI1_AHB2PHY_BROADCAST_ADDRESS_SPACE_5_ADDR A:0x49f814
y.create.l HWIO_EBI1_AHB2PHY_BROADCAST_ADDRESS_SPACE_6_ADDR A:0x49f818
y.create.l HWIO_EBI1_AHB2PHY_BROADCAST_ADDRESS_SPACE_7_ADDR A:0x49f81c
y.create.l HWIO_EBI1_AHB2PHY_BROADCAST_ADDRESS_SPACE_8_ADDR A:0x49f820
y.create.l HWIO_EBI1_AHB2PHY_BROADCAST_ADDRESS_SPACE_9_ADDR A:0x49f824
y.create.l HWIO_MDSS_MDP_SYNC_CONFIG_0_ADDR A:0x1a00300
y.create.l HWIO_MDSS_MDP_SYNC_CONFIG_1_ADDR A:0x1a00304
y.create.l HWIO_MDSS_MDP_SYNC_CONFIG_2_ADDR A:0x1a00308
y.create.l HWIO_MDSS_MDP_SYNC_STATUS_0_ADDR A:0x1a0030c
y.create.l HWIO_MDSS_MDP_SYNC_STATUS_1_ADDR A:0x1a00310
y.create.l HWIO_MDSS_MDP_SYNC_STATUS_2_ADDR A:0x1a00314
y.create.l HWIO_MDSS_MDP_PRIMARY_VSYNC_OUT_CTRL_ADDR A:0x1a00318
y.create.l HWIO_MDSS_MDP_SECONDARY_VSYNC_OUT_CTRL_ADDR A:0x1a0031c
y.create.l HWIO_MDSS_MDP_EXTERNAL_VSYNC_OUT_CTRL_ADDR A:0x1a00320
y.create.l HWIO_MDSS_MDP_VSYNC_SEL_ADDR A:0x1a00324
y.create.l HWIO_MDSS_MDP_PRIM_VSYNC_INIT_VAL_ADDR A:0x1a00328
y.create.l HWIO_MDSS_MDP_SEC_VSYNC_INIT_VAL_ADDR A:0x1a0032c
y.create.l HWIO_MDSS_MDP_EXT_VSYNC_INIT_VAL_ADDR A:0x1a00330
y.create.l HWIO_MDSS_MDP_PRIM_VSYNC_OUT_VAL_ADDR A:0x1a00334
y.create.l HWIO_MDSS_MDP_SEC_VSYNC_OUT_VAL_ADDR A:0x1a00338
y.create.l HWIO_MDSS_MDP_EXT_VSYNC_OUT_VAL_ADDR A:0x1a0033c
y.create.l HWIO_MDSS_MDP_PRIM_INT_CNT_VAL_ADDR A:0x1a00340
y.create.l HWIO_MDSS_MDP_SEC_INT_CNT_VAL_ADDR A:0x1a00344
y.create.l HWIO_MDSS_MDP_EXT_INT_CNT_VAL_ADDR A:0x1a00348
y.create.l HWIO_MDSS_MDP_AUTOREFRESH_CONFIG_P_ADDR A:0x1a0034c
y.create.l HWIO_MDSS_MDP_AUTOREFRESH_CONFIG_S_ADDR A:0x1a00350
y.create.l HWIO_MDSS_MDP_QPIC_EOF_VAL_ADDR A:0x1a00354
y.create.l HWIO_MDSS_MDP_SYNC_THRESH_0_ADDR A:0x1a00200
y.create.l HWIO_MDSS_MDP_SYNC_THRESH_1_ADDR A:0x1a00204
y.create.l HWIO_MDSS_MDP_SYNC_THRESH_2_ADDR A:0x1a00208
y.create.l HWIO_MDSS_MDP_TEAR_CHECK_EN_ADDR A:0x1a0020c
y.create.l HWIO_MDSS_MDP_PRIM_START_POS_ADDR A:0x1a00210
y.create.l HWIO_MDSS_MDP_SEC_START_POS_ADDR A:0x1a00214
y.create.l HWIO_MDSS_MDP_EXT_START_POS_ADDR A:0x1a00218
y.create.l HWIO_MDSS_MDP_PRIMARY_RD_PTR_IRQ_ADDR A:0x1a0021c
y.create.l HWIO_MDSS_MDP_SECONDARY_RD_PTR_IRQ_ADDR A:0x1a00220
y.create.l HWIO_MDSS_MDP_EXTERNAL_RD_PTR_IRQ_ADDR A:0x1a00224
y.create.l HWIO_MDSS_MDP_INTR_ENABLE_ADDR A:0x1a00020
y.create.l HWIO_MDSS_MDP_INTR_STATUS_ADDR A:0x1a00024
y.create.l HWIO_MDSS_MDP_INTR_CLEAR_ADDR A:0x1a00028
y.create.l HWIO_MDSS_MDP_PPP_DL0_START_ADDR A:0x1a00030
y.create.l HWIO_MDSS_MDP_PPP_DL1_START_ADDR A:0x1a00034
y.create.l HWIO_MDSS_MDP_DISPLAY_STATUS_ADDR A:0x1a00038
y.create.l HWIO_MDSS_MDP_DMA_P_START_ADDR A:0x1a00044
y.create.l HWIO_MDSS_MDP_DMA_S_START_ADDR A:0x1a00048
y.create.l HWIO_MDSS_MDP_DMA_E_START_ADDR A:0x1a0004c
y.create.l HWIO_MDSS_MDP_HW_VERSION_ADDR A:0x1a00070
y.create.l HWIO_MDSS_MDP_SW_RESET_ADDR A:0x1a00074
y.create.l HWIO_MDSS_MDP_AXI_RD_ARB_CONFIG_ADDR A:0x1a00078
y.create.l HWIO_MDSS_MDP_SEL_CLK_OR_HCLK_TEST_BUS_ADDR A:0x1a0007c
y.create.l HWIO_MDSS_MDP_EBI2_LCD0_ADDR A:0x1a0003c
y.create.l HWIO_MDSS_MDP_EBI2_LCD1_ADDR A:0x1a00040
y.create.l HWIO_MDSS_MDP_EBI2_LCD0_YSTRIDE_ADDR A:0x1a00050
y.create.l HWIO_MDSS_MDP_EBI2_LCD1_YSTRIDE_ADDR A:0x1a00054
y.create.l HWIO_MDSS_MDP_EBI2_PORTMAP_MODE_ADDR A:0x1a0005c
y.create.l HWIO_MDSS_MDP_HALT_REQ_ACK_ADDR A:0x1a00060
y.create.l HWIO_MDSS_MDP_MDDI_PARAM_WR_SEL_ADDR A:0x1a00090
y.create.l HWIO_MDSS_MDP_MDDI_PARAM_ADDR A:0x1a00094
y.create.l HWIO_MDSS_MDP_CGC_EN_ADDR A:0x1a00100
y.create.l HWIO_MDSS_DEBUGBUS_VBIF_ATB_ADDR A:0x1a00104
y.create.l HWIO_MDSS_MDP_PPP_DL0_ADDR_ADDR A:0x1a10000
y.create.l HWIO_MDSS_MDP_PPP_DL1_ADDR_ADDR A:0x1a10004
y.create.l HWIO_MDSS_MDP_PPP_CMD_STATUS_ADDR A:0x1a10008
y.create.l HWIO_MDSS_MDP_PPP_PROFILE_EN_ADDR A:0x1a10010
y.create.l HWIO_MDSS_MDP_PPP_PROFILE_COUNT_ADDR A:0x1a10014
y.create.l HWIO_MDSS_MDP_PPP_CMD_MODE_ADDR A:0x1a10060
y.create.l HWIO_MDSS_MDP_PPP_SRC_SIZE_ADDR A:0x1a10108
y.create.l HWIO_MDSS_MDP_PPP_SRCP0_ADDR_ADDR A:0x1a1010c
y.create.l HWIO_MDSS_MDP_PPP_SRCP1_ADDR_ADDR A:0x1a10110
y.create.l HWIO_MDSS_MDP_PPP_SRCP3_ADDR_ADDR A:0x1a10118
y.create.l HWIO_MDSS_MDP_PPP_SRC_YSTRIDE1_ADDR A:0x1a1011c
y.create.l HWIO_MDSS_MDP_PPP_SRC_YSTRIDE2_ADDR A:0x1a10120
y.create.l HWIO_MDSS_MDP_PPP_SRC_FORMAT_ADDR A:0x1a10124
y.create.l HWIO_MDSS_MDP_PPP_SRC_UNPACK_PATTERN1_ADDR A:0x1a10128
y.create.l HWIO_MDSS_MDP_PPP_SRC_UNPACK_PATTERN2_ADDR A:0x1a1012c
y.create.l HWIO_MDSS_MDP_PPP_OP_MODE_ADDR A:0x1a10138
y.create.l HWIO_MDSS_MDP_PPP_SCALE_PHASEX_INIT_ADDR A:0x1a1013c
y.create.l HWIO_MDSS_MDP_PPP_SCALE_PHASEY_INIT_ADDR A:0x1a10140
y.create.l HWIO_MDSS_MDP_PPP_SCALE_PHASEX_STEP_ADDR A:0x1a10144
y.create.l HWIO_MDSS_MDP_PPP_SCALE_PHASEY_STEP_ADDR A:0x1a10148
y.create.l HWIO_MDSS_MDP_PPP_BLEND_PARAM_ADDR A:0x1a1014c
y.create.l HWIO_MDSS_MDP_PPP_OUT_FORMAT_ADDR A:0x1a10150
y.create.l HWIO_MDSS_MDP_PPP_OUT_PACK_PATTERN1_ADDR A:0x1a10154
y.create.l HWIO_MDSS_MDP_PPP_OUT_PACK_PATTERN2_ADDR A:0x1a10158
y.create.l HWIO_MDSS_MDP_PPP_OUT_SIZE_ADDR A:0x1a10164
y.create.l HWIO_MDSS_MDP_PPP_OUTP0_ADDR_ADDR A:0x1a10168
y.create.l HWIO_MDSS_MDP_PPP_OUTP1_ADDR_ADDR A:0x1a1016c
y.create.l HWIO_MDSS_MDP_PPP_OUTP3_ADDR_ADDR A:0x1a10174
y.create.l HWIO_MDSS_MDP_PPP_OUT_YSTRIDE1_ADDR A:0x1a10178
y.create.l HWIO_MDSS_MDP_PPP_OUT_YSTRIDE2_ADDR A:0x1a1017c
y.create.l HWIO_MDSS_MDP_PPP_OUT_XY_ADDR A:0x1a1019c
y.create.l HWIO_MDSS_MDP_PPP_SRC_EDGE_REP_ADDR A:0x1a101b8
y.create.l HWIO_MDSS_MDP_PPP_BG_EDGE_REP_ADDR A:0x1a101bc
y.create.l HWIO_MDSS_MDP_PPP_BGP0_ADDR_ADDR A:0x1a101c0
y.create.l HWIO_MDSS_MDP_PPP_BGP1_ADDR_ADDR A:0x1a101c4
y.create.l HWIO_MDSS_MDP_PPP_BGP3_ADDR_ADDR A:0x1a101c8
y.create.l HWIO_MDSS_MDP_PPP_BG_YSTRIDE1_ADDR A:0x1a101cc
y.create.l HWIO_MDSS_MDP_PPP_BG_YSTRIDE2_ADDR A:0x1a101d0
y.create.l HWIO_MDSS_MDP_PPP_BG_FORMAT_ADDR A:0x1a101d4
y.create.l HWIO_MDSS_MDP_PPP_BG_UNPACK_PATTERN1_ADDR A:0x1a101d8
y.create.l HWIO_MDSS_MDP_PPP_BG_UNPACK_PATTERN2_ADDR A:0x1a101dc
y.create.l HWIO_MDSS_MDP_PPP_TFETCH_TEST_MODE_ADDR A:0x1a20004
y.create.l HWIO_MDSS_MDP_PPP_TFETCH_STATUS_ADDR A:0x1a20008
y.create.l HWIO_MDSS_MDP_PPP_TFETCH_TILE_COUNT_ADDR A:0x1a20010
y.create.l HWIO_MDSS_MDP_PPP_TFETCH_FETCH_COUNT_ADDR A:0x1a20014
y.create.l HWIO_MDSS_MDP_PPP_TFETCH_CONSTANT_COLOR_ADDR A:0x1a20040
y.create.l HWIO_MDSS_MDP_PPP_PRIORITY_QOS_REMAPPER_ADDR A:0x1a21000
y.create.l HWIO_MDSS_MDP_PPP_PRIORITYLVL_QOS_REMAPPER_ADDR A:0x1a21004
y.create.l HWIO_MDSS_MDP_PPP_CSC_BYPASS_ADDR A:0x1a40004
y.create.l HWIO_MDSS_MDP_PPP_CSC_PFMV0_ADDR A:0x1a40400
y.create.l HWIO_MDSS_MDP_PPP_CSC_PFMV1_ADDR A:0x1a40404
y.create.l HWIO_MDSS_MDP_PPP_CSC_PFMV2_ADDR A:0x1a40408
y.create.l HWIO_MDSS_MDP_PPP_CSC_PFMV3_ADDR A:0x1a4040c
y.create.l HWIO_MDSS_MDP_PPP_CSC_PFMV4_ADDR A:0x1a40410
y.create.l HWIO_MDSS_MDP_PPP_CSC_PFMV5_ADDR A:0x1a40414
y.create.l HWIO_MDSS_MDP_PPP_CSC_PFMV6_ADDR A:0x1a40418
y.create.l HWIO_MDSS_MDP_PPP_CSC_PFMV7_ADDR A:0x1a4041c
y.create.l HWIO_MDSS_MDP_PPP_CSC_PFMV8_ADDR A:0x1a40420
y.create.l HWIO_MDSS_MDP_PPP_CSC_PRMV0_ADDR A:0x1a40440
y.create.l HWIO_MDSS_MDP_PPP_CSC_PRMV1_ADDR A:0x1a40444
y.create.l HWIO_MDSS_MDP_PPP_CSC_PRMV2_ADDR A:0x1a40448
y.create.l HWIO_MDSS_MDP_PPP_CSC_PRMV3_ADDR A:0x1a4044c
y.create.l HWIO_MDSS_MDP_PPP_CSC_PRMV4_ADDR A:0x1a40450
y.create.l HWIO_MDSS_MDP_PPP_CSC_PRMV5_ADDR A:0x1a40454
y.create.l HWIO_MDSS_MDP_PPP_CSC_PRMV6_ADDR A:0x1a40458
y.create.l HWIO_MDSS_MDP_PPP_CSC_PRMV7_ADDR A:0x1a4045c
y.create.l HWIO_MDSS_MDP_PPP_CSC_PRMV8_ADDR A:0x1a40460
y.create.l HWIO_MDSS_MDP_PPP_CSC_SFMV0_ADDR A:0x1a40480
y.create.l HWIO_MDSS_MDP_PPP_CSC_SFMV1_ADDR A:0x1a40484
y.create.l HWIO_MDSS_MDP_PPP_CSC_SFMV2_ADDR A:0x1a40488
y.create.l HWIO_MDSS_MDP_PPP_CSC_SFMV3_ADDR A:0x1a4048c
y.create.l HWIO_MDSS_MDP_PPP_CSC_SFMV4_ADDR A:0x1a40490
y.create.l HWIO_MDSS_MDP_PPP_CSC_SFMV5_ADDR A:0x1a40494
y.create.l HWIO_MDSS_MDP_PPP_CSC_SFMV6_ADDR A:0x1a40498
y.create.l HWIO_MDSS_MDP_PPP_CSC_SFMV7_ADDR A:0x1a4049c
y.create.l HWIO_MDSS_MDP_PPP_CSC_SFMV8_ADDR A:0x1a404a0
y.create.l HWIO_MDSS_MDP_PPP_CSC_SRMV0_ADDR A:0x1a404c0
y.create.l HWIO_MDSS_MDP_PPP_CSC_SRMV1_ADDR A:0x1a404c4
y.create.l HWIO_MDSS_MDP_PPP_CSC_SRMV2_ADDR A:0x1a404c8
y.create.l HWIO_MDSS_MDP_PPP_CSC_SRMV3_ADDR A:0x1a404cc
y.create.l HWIO_MDSS_MDP_PPP_CSC_SRMV4_ADDR A:0x1a404d0
y.create.l HWIO_MDSS_MDP_PPP_CSC_SRMV5_ADDR A:0x1a404d4
y.create.l HWIO_MDSS_MDP_PPP_CSC_SRMV6_ADDR A:0x1a404d8
y.create.l HWIO_MDSS_MDP_PPP_CSC_SRMV7_ADDR A:0x1a404dc
y.create.l HWIO_MDSS_MDP_PPP_CSC_SRMV8_ADDR A:0x1a404e0
y.create.l HWIO_MDSS_MDP_PPP_CSC_PBV0_ADDR A:0x1a40500
y.create.l HWIO_MDSS_MDP_PPP_CSC_PBV1_ADDR A:0x1a40504
y.create.l HWIO_MDSS_MDP_PPP_CSC_PBV2_ADDR A:0x1a40508
y.create.l HWIO_MDSS_MDP_PPP_CSC_SBV0_ADDR A:0x1a40540
y.create.l HWIO_MDSS_MDP_PPP_CSC_SBV1_ADDR A:0x1a40544
y.create.l HWIO_MDSS_MDP_PPP_CSC_SBV2_ADDR A:0x1a40548
y.create.l HWIO_MDSS_MDP_PPP_CSC_PLV0_ADDR A:0x1a40580
y.create.l HWIO_MDSS_MDP_PPP_CSC_PLV1_ADDR A:0x1a40584
y.create.l HWIO_MDSS_MDP_PPP_CSC_PLV2_ADDR A:0x1a40588
y.create.l HWIO_MDSS_MDP_PPP_CSC_PLV3_ADDR A:0x1a4058c
y.create.l HWIO_MDSS_MDP_PPP_CSC_SLV0_ADDR A:0x1a405c0
y.create.l HWIO_MDSS_MDP_PPP_CSC_SLV1_ADDR A:0x1a405c4
y.create.l HWIO_MDSS_MDP_PPP_CSC_SLV2_ADDR A:0x1a405c8
y.create.l HWIO_MDSS_MDP_PPP_CSC_SLV3_ADDR A:0x1a405cc
y.create.l HWIO_MDSS_MDP_PPP_CSC_PRELT0_ADDR A:0x1a40800
y.create.l HWIO_MDSS_MDP_PPP_CSC_PRELT1_ADDR A:0x1a40804
y.create.l HWIO_MDSS_MDP_PPP_CSC_PRELT2_ADDR A:0x1a40808
y.create.l HWIO_MDSS_MDP_PPP_CSC_PRELT3_ADDR A:0x1a4080c
y.create.l HWIO_MDSS_MDP_PPP_CSC_PRELT4_ADDR A:0x1a40810
y.create.l HWIO_MDSS_MDP_PPP_CSC_PRELT5_ADDR A:0x1a40814
y.create.l HWIO_MDSS_MDP_PPP_CSC_PRELT6_ADDR A:0x1a40818
y.create.l HWIO_MDSS_MDP_PPP_CSC_PRELT7_ADDR A:0x1a4081c
y.create.l HWIO_MDSS_MDP_PPP_CSC_PRELT8_ADDR A:0x1a40820
y.create.l HWIO_MDSS_MDP_PPP_CSC_PRELT9_ADDR A:0x1a40824
y.create.l HWIO_MDSS_MDP_PPP_CSC_POSTLT0_ADDR A:0x1a40c00
y.create.l HWIO_MDSS_MDP_PPP_CSC_POSTLT1_ADDR A:0x1a40c04
y.create.l HWIO_MDSS_MDP_PPP_CSC_POSTLT2_ADDR A:0x1a40c08
y.create.l HWIO_MDSS_MDP_PPP_CSC_POSTLT3_ADDR A:0x1a40c0c
y.create.l HWIO_MDSS_MDP_PPP_CSC_POSTLT4_ADDR A:0x1a40c10
y.create.l HWIO_MDSS_MDP_PPP_CSC_POSTLT5_ADDR A:0x1a40c14
y.create.l HWIO_MDSS_MDP_PPP_CSC_POSTLT6_ADDR A:0x1a40c18
y.create.l HWIO_MDSS_MDP_PPP_CSC_POSTLT7_ADDR A:0x1a40c1c
y.create.l HWIO_MDSS_MDP_PPP_CSC_POSTLT8_ADDR A:0x1a40c20
y.create.l HWIO_MDSS_MDP_PPP_CSC_POSTLT9_ADDR A:0x1a40c24
y.create.l HWIO_MDSS_MDP_PPP_SCALE_COEFF_MSB0_ADDR A:0x1a50200
y.create.l HWIO_MDSS_MDP_PPP_SCALE_COEFF_MSB1_ADDR A:0x1a50204
y.create.l HWIO_MDSS_MDP_PPP_SCALE_COEFF_MSB2_ADDR A:0x1a50208
y.create.l HWIO_MDSS_MDP_PPP_SCALE_COEFF_MSB3_ADDR A:0x1a5020c
y.create.l HWIO_MDSS_MDP_PPP_SCALE_COEFF_MSB4_ADDR A:0x1a50210
y.create.l HWIO_MDSS_MDP_PPP_SCALE_COEFF_MSB5_ADDR A:0x1a50214
y.create.l HWIO_MDSS_MDP_PPP_SCALE_COEFF_MSB6_ADDR A:0x1a50218
y.create.l HWIO_MDSS_MDP_PPP_SCALE_COEFF_MSB7_ADDR A:0x1a5021c
y.create.l HWIO_MDSS_MDP_PPP_SCALE_COEFF_MSB8_ADDR A:0x1a50220
y.create.l HWIO_MDSS_MDP_PPP_SCALE_COEFF_MSB9_ADDR A:0x1a50224
y.create.l HWIO_MDSS_MDP_PPP_SCALE_COEFF_LSB_ADDR A:0x1a5fffc
y.create.l HWIO_MDSS_MDP_PPP_BLEND_COLOR3_OUT_ADDR A:0x1a70004
y.create.l HWIO_MDSS_MDP_PPP_BLEND_BG_ALPHA_SEL_ADDR A:0x1a70010
y.create.l HWIO_MDSS_MDP_DMA_P_CONFIG_ADDR A:0x1a90000
y.create.l HWIO_MDSS_MDP_DMA_P_SIZE_ADDR A:0x1a90004
y.create.l HWIO_MDSS_MDP_DMA_P_IBUF_ADDR_ADDR A:0x1a90008
y.create.l HWIO_MDSS_MDP_DMA_P_IBUF_Y_STRIDE_ADDR A:0x1a9000c
y.create.l HWIO_MDSS_MDP_DMA_P_OUT_XY_ADDR A:0x1a90010
y.create.l HWIO_MDSS_MDP_DMA_P_LINE_COUNT_ADDR A:0x1a90014
y.create.l HWIO_MDSS_MDP_DMA_P_LINE_IRQ_ADDR A:0x1a90018
y.create.l HWIO_MDSS_MDP_DMA_P_MASK_PATTERN_ADDR A:0x1a9001c
y.create.l HWIO_MDSS_MDP_DMA_P_PROFILE_EN_ADDR A:0x1a90020
y.create.l HWIO_MDSS_MDP_DMA_P_PROFILE_COUNT_ADDR A:0x1a90024
y.create.l HWIO_MDSS_MDP_DMA_P_CURSOR_FORMAT_ADDR A:0x1a90040
y.create.l HWIO_MDSS_MDP_DMA_P_CURSOR_SIZE_ADDR A:0x1a90044
y.create.l HWIO_MDSS_MDP_DMA_P_CURSOR_BUF_ADDR_ADDR A:0x1a90048
y.create.l HWIO_MDSS_MDP_DMA_P_CURSOR_POSITION_ADDR A:0x1a9004c
y.create.l HWIO_MDSS_MDP_DMA_P_CURSOR_BLEND_CONFIG_ADDR A:0x1a90060
y.create.l HWIO_MDSS_MDP_DMA_P_CURSOR_BLEND_PARAM_ADDR A:0x1a90064
y.create.l HWIO_MDSS_MDP_DMA_P_CURSOR_BLEND_TRANS_MASK_ADDR A:0x1a90068
y.create.l HWIO_MDSS_MDP_DMA_P_COLOR_CORRECT_CONFIG_ADDR A:0x1a90070
y.create.l HWIO_MDSS_MDP_DMA_P_CSC_BYPASS_ADDR A:0x1a93004
y.create.l HWIO_MDSS_MDP_DMA_P_CSC_MV10_ADDR A:0x1a93400
y.create.l HWIO_MDSS_MDP_DMA_P_CSC_MV11_ADDR A:0x1a93404
y.create.l HWIO_MDSS_MDP_DMA_P_CSC_MV12_ADDR A:0x1a93408
y.create.l HWIO_MDSS_MDP_DMA_P_CSC_MV13_ADDR A:0x1a9340c
y.create.l HWIO_MDSS_MDP_DMA_P_CSC_MV14_ADDR A:0x1a93410
y.create.l HWIO_MDSS_MDP_DMA_P_CSC_MV15_ADDR A:0x1a93414
y.create.l HWIO_MDSS_MDP_DMA_P_CSC_MV16_ADDR A:0x1a93418
y.create.l HWIO_MDSS_MDP_DMA_P_CSC_MV17_ADDR A:0x1a9341c
y.create.l HWIO_MDSS_MDP_DMA_P_CSC_MV18_ADDR A:0x1a93420
y.create.l HWIO_MDSS_MDP_DMA_P_CSC_MV20_ADDR A:0x1a93440
y.create.l HWIO_MDSS_MDP_DMA_P_CSC_MV21_ADDR A:0x1a93444
y.create.l HWIO_MDSS_MDP_DMA_P_CSC_MV22_ADDR A:0x1a93448
y.create.l HWIO_MDSS_MDP_DMA_P_CSC_MV23_ADDR A:0x1a9344c
y.create.l HWIO_MDSS_MDP_DMA_P_CSC_MV24_ADDR A:0x1a93450
y.create.l HWIO_MDSS_MDP_DMA_P_CSC_MV25_ADDR A:0x1a93454
y.create.l HWIO_MDSS_MDP_DMA_P_CSC_MV26_ADDR A:0x1a93458
y.create.l HWIO_MDSS_MDP_DMA_P_CSC_MV27_ADDR A:0x1a9345c
y.create.l HWIO_MDSS_MDP_DMA_P_CSC_MV28_ADDR A:0x1a93460
y.create.l HWIO_MDSS_MDP_DMA_P_CSC_PRE_BV10_ADDR A:0x1a93500
y.create.l HWIO_MDSS_MDP_DMA_P_CSC_PRE_BV11_ADDR A:0x1a93504
y.create.l HWIO_MDSS_MDP_DMA_P_CSC_PRE_BV12_ADDR A:0x1a93508
y.create.l HWIO_MDSS_MDP_DMA_P_CSC_PRE_BV20_ADDR A:0x1a93540
y.create.l HWIO_MDSS_MDP_DMA_P_CSC_PRE_BV21_ADDR A:0x1a93544
y.create.l HWIO_MDSS_MDP_DMA_P_CSC_PRE_BV22_ADDR A:0x1a93548
y.create.l HWIO_MDSS_MDP_DMA_P_CSC_POST_BV10_ADDR A:0x1a93580
y.create.l HWIO_MDSS_MDP_DMA_P_CSC_POST_BV11_ADDR A:0x1a93584
y.create.l HWIO_MDSS_MDP_DMA_P_CSC_POST_BV12_ADDR A:0x1a93588
y.create.l HWIO_MDSS_MDP_DMA_P_CSC_POST_BV20_ADDR A:0x1a935c0
y.create.l HWIO_MDSS_MDP_DMA_P_CSC_POST_BV21_ADDR A:0x1a935c4
y.create.l HWIO_MDSS_MDP_DMA_P_CSC_POST_BV22_ADDR A:0x1a935c8
y.create.l HWIO_MDSS_MDP_DMA_P_CSC_PRE_LV10_ADDR A:0x1a93600
y.create.l HWIO_MDSS_MDP_DMA_P_CSC_PRE_LV11_ADDR A:0x1a93604
y.create.l HWIO_MDSS_MDP_DMA_P_CSC_PRE_LV12_ADDR A:0x1a93608
y.create.l HWIO_MDSS_MDP_DMA_P_CSC_PRE_LV13_ADDR A:0x1a9360c
y.create.l HWIO_MDSS_MDP_DMA_P_CSC_PRE_LV14_ADDR A:0x1a93610
y.create.l HWIO_MDSS_MDP_DMA_P_CSC_PRE_LV15_ADDR A:0x1a93614
y.create.l HWIO_MDSS_MDP_DMA_P_CSC_PRE_LV20_ADDR A:0x1a93640
y.create.l HWIO_MDSS_MDP_DMA_P_CSC_PRE_LV21_ADDR A:0x1a93644
y.create.l HWIO_MDSS_MDP_DMA_P_CSC_PRE_LV22_ADDR A:0x1a93648
y.create.l HWIO_MDSS_MDP_DMA_P_CSC_PRE_LV23_ADDR A:0x1a9364c
y.create.l HWIO_MDSS_MDP_DMA_P_CSC_PRE_LV24_ADDR A:0x1a93650
y.create.l HWIO_MDSS_MDP_DMA_P_CSC_PRE_LV25_ADDR A:0x1a93654
y.create.l HWIO_MDSS_MDP_DMA_P_CSC_POST_LV10_ADDR A:0x1a93680
y.create.l HWIO_MDSS_MDP_DMA_P_CSC_POST_LV11_ADDR A:0x1a93684
y.create.l HWIO_MDSS_MDP_DMA_P_CSC_POST_LV12_ADDR A:0x1a93688
y.create.l HWIO_MDSS_MDP_DMA_P_CSC_POST_LV13_ADDR A:0x1a9368c
y.create.l HWIO_MDSS_MDP_DMA_P_CSC_POST_LV14_ADDR A:0x1a93690
y.create.l HWIO_MDSS_MDP_DMA_P_CSC_POST_LV15_ADDR A:0x1a93694
y.create.l HWIO_MDSS_MDP_DMA_P_CSC_POST_LV20_ADDR A:0x1a936c0
y.create.l HWIO_MDSS_MDP_DMA_P_CSC_POST_LV21_ADDR A:0x1a936c4
y.create.l HWIO_MDSS_MDP_DMA_P_CSC_POST_LV22_ADDR A:0x1a936c8
y.create.l HWIO_MDSS_MDP_DMA_P_CSC_POST_LV23_ADDR A:0x1a936cc
y.create.l HWIO_MDSS_MDP_DMA_P_CSC_POST_LV24_ADDR A:0x1a936d0
y.create.l HWIO_MDSS_MDP_DMA_P_CSC_POST_LV25_ADDR A:0x1a936d4
y.create.l HWIO_MDSS_MDP_DMA_P_CSC_LUT10_ADDR A:0x1a93800
y.create.l HWIO_MDSS_MDP_DMA_P_CSC_LUT11_ADDR A:0x1a93804
y.create.l HWIO_MDSS_MDP_DMA_P_CSC_LUT12_ADDR A:0x1a93808
y.create.l HWIO_MDSS_MDP_DMA_P_CSC_LUT13_ADDR A:0x1a9380c
y.create.l HWIO_MDSS_MDP_DMA_P_CSC_LUT14_ADDR A:0x1a93810
y.create.l HWIO_MDSS_MDP_DMA_P_CSC_LUT15_ADDR A:0x1a93814
y.create.l HWIO_MDSS_MDP_DMA_P_CSC_LUT16_ADDR A:0x1a93818
y.create.l HWIO_MDSS_MDP_DMA_P_CSC_LUT17_ADDR A:0x1a9381c
y.create.l HWIO_MDSS_MDP_DMA_P_CSC_LUT18_ADDR A:0x1a93820
y.create.l HWIO_MDSS_MDP_DMA_P_CSC_LUT19_ADDR A:0x1a93824
y.create.l HWIO_MDSS_MDP_DMA_P_CSC_LUT20_ADDR A:0x1a93c00
y.create.l HWIO_MDSS_MDP_DMA_P_CSC_LUT21_ADDR A:0x1a93c04
y.create.l HWIO_MDSS_MDP_DMA_P_CSC_LUT22_ADDR A:0x1a93c08
y.create.l HWIO_MDSS_MDP_DMA_P_CSC_LUT23_ADDR A:0x1a93c0c
y.create.l HWIO_MDSS_MDP_DMA_P_CSC_LUT24_ADDR A:0x1a93c10
y.create.l HWIO_MDSS_MDP_DMA_P_CSC_LUT25_ADDR A:0x1a93c14
y.create.l HWIO_MDSS_MDP_DMA_P_CSC_LUT26_ADDR A:0x1a93c18
y.create.l HWIO_MDSS_MDP_DMA_P_CSC_LUT27_ADDR A:0x1a93c1c
y.create.l HWIO_MDSS_MDP_DMA_P_CSC_LUT28_ADDR A:0x1a93c20
y.create.l HWIO_MDSS_MDP_DMA_P_CSC_LUT29_ADDR A:0x1a93c24
y.create.l HWIO_MDSS_MDP_DMA_P_HIST_START_ADDR A:0x1a94000
y.create.l HWIO_MDSS_MDP_DMA_P_HIST_FRAME_CNT_ADDR A:0x1a94004
y.create.l HWIO_MDSS_MDP_DMA_P_HIST_BIT_MASK_ADDR A:0x1a94008
y.create.l HWIO_MDSS_MDP_DMA_P_HIST_RESET_SEQ_START_ADDR A:0x1a9400c
y.create.l HWIO_MDSS_MDP_DMA_P_HIST_CONTROL_ADDR A:0x1a94010
y.create.l HWIO_MDSS_MDP_DMA_P_HIST_INTR_STATUS_ADDR A:0x1a94014
y.create.l HWIO_MDSS_MDP_DMA_P_HIST_INTR_CLEAR_ADDR A:0x1a94018
y.create.l HWIO_MDSS_MDP_DMA_P_HIST_INTR_ENABLE_ADDR A:0x1a9401c
y.create.l HWIO_MDSS_MDP_DMA_P_HIST_STOP_REQ_ADDR A:0x1a94020
y.create.l HWIO_MDSS_MDP_DMA_P_HIST_CANCEL_REQ_ADDR A:0x1a94024
y.create.l HWIO_MDSS_MDP_DMA_P_HIST_EXTRA_INFO_0_ADDR A:0x1a94028
y.create.l HWIO_MDSS_MDP_DMA_P_HIST_EXTRA_INFO_1_ADDR A:0x1a9402c
y.create.l HWIO_MDSS_MDP_DMA_P_HIST_R_DATA0_ADDR A:0x1a94100
y.create.l HWIO_MDSS_MDP_DMA_P_HIST_R_DATA1_ADDR A:0x1a94104
y.create.l HWIO_MDSS_MDP_DMA_P_HIST_R_DATA2_ADDR A:0x1a94108
y.create.l HWIO_MDSS_MDP_DMA_P_HIST_R_DATA3_ADDR A:0x1a9410c
y.create.l HWIO_MDSS_MDP_DMA_P_HIST_R_DATA4_ADDR A:0x1a94110
y.create.l HWIO_MDSS_MDP_DMA_P_HIST_R_DATA5_ADDR A:0x1a94114
y.create.l HWIO_MDSS_MDP_DMA_P_HIST_R_DATA6_ADDR A:0x1a94118
y.create.l HWIO_MDSS_MDP_DMA_P_HIST_R_DATA7_ADDR A:0x1a9411c
y.create.l HWIO_MDSS_MDP_DMA_P_HIST_R_DATA8_ADDR A:0x1a94120
y.create.l HWIO_MDSS_MDP_DMA_P_HIST_R_DATA9_ADDR A:0x1a94124
y.create.l HWIO_MDSS_MDP_DMA_P_HIST_G_DATA0_ADDR A:0x1a94200
y.create.l HWIO_MDSS_MDP_DMA_P_HIST_G_DATA1_ADDR A:0x1a94204
y.create.l HWIO_MDSS_MDP_DMA_P_HIST_G_DATA2_ADDR A:0x1a94208
y.create.l HWIO_MDSS_MDP_DMA_P_HIST_G_DATA3_ADDR A:0x1a9420c
y.create.l HWIO_MDSS_MDP_DMA_P_HIST_G_DATA4_ADDR A:0x1a94210
y.create.l HWIO_MDSS_MDP_DMA_P_HIST_G_DATA5_ADDR A:0x1a94214
y.create.l HWIO_MDSS_MDP_DMA_P_HIST_G_DATA6_ADDR A:0x1a94218
y.create.l HWIO_MDSS_MDP_DMA_P_HIST_G_DATA7_ADDR A:0x1a9421c
y.create.l HWIO_MDSS_MDP_DMA_P_HIST_G_DATA8_ADDR A:0x1a94220
y.create.l HWIO_MDSS_MDP_DMA_P_HIST_G_DATA9_ADDR A:0x1a94224
y.create.l HWIO_MDSS_MDP_DMA_P_HIST_B_DATA0_ADDR A:0x1a94300
y.create.l HWIO_MDSS_MDP_DMA_P_HIST_B_DATA1_ADDR A:0x1a94304
y.create.l HWIO_MDSS_MDP_DMA_P_HIST_B_DATA2_ADDR A:0x1a94308
y.create.l HWIO_MDSS_MDP_DMA_P_HIST_B_DATA3_ADDR A:0x1a9430c
y.create.l HWIO_MDSS_MDP_DMA_P_HIST_B_DATA4_ADDR A:0x1a94310
y.create.l HWIO_MDSS_MDP_DMA_P_HIST_B_DATA5_ADDR A:0x1a94314
y.create.l HWIO_MDSS_MDP_DMA_P_HIST_B_DATA6_ADDR A:0x1a94318
y.create.l HWIO_MDSS_MDP_DMA_P_HIST_B_DATA7_ADDR A:0x1a9431c
y.create.l HWIO_MDSS_MDP_DMA_P_HIST_B_DATA8_ADDR A:0x1a94320
y.create.l HWIO_MDSS_MDP_DMA_P_HIST_B_DATA9_ADDR A:0x1a94324
y.create.l HWIO_MDSS_MDP_DMA_P_FETCH_CFG_ADDR A:0x1a90074
y.create.l HWIO_MDSS_MDP_DMA_P_PKR_ADDR_ADDR A:0x1a90078
y.create.l HWIO_MDSS_MDP_DMA_P_DCVS_CTRL_ADDR A:0x1a90080
y.create.l HWIO_MDSS_MDP_DMA_P_DCVS_STATUS_ADDR A:0x1a90084
y.create.l HWIO_MDSS_MDP_DMA_P_QOS_REMAPPER_ADDR A:0x1a90090
y.create.l HWIO_MDSS_MDP_DMA_P_WATERMARK_0_ADDR A:0x1a90094
y.create.l HWIO_MDSS_MDP_DMA_P_WATERMARK_1_ADDR A:0x1a90098
y.create.l HWIO_MDSS_MDP_DMA_P_WATERMARK_2_ADDR A:0x1a9009c
y.create.l HWIO_MDSS_MDP_PANIC_ROBUST_CTRL_ADDR A:0x1a900a0
y.create.l HWIO_MDSS_MDP_PANIC_LUT0_ADDR A:0x1a900a4
y.create.l HWIO_MDSS_MDP_PANIC_LUT1_ADDR A:0x1a900a8
y.create.l HWIO_MDSS_MDP_ROBUST_LUT_ADDR A:0x1a900ac
y.create.l HWIO_MDSS_MDP_DMA_S_CONFIG_ADDR A:0x1aa0000
y.create.l HWIO_MDSS_MDP_DMA_S_SIZE_ADDR A:0x1aa0004
y.create.l HWIO_MDSS_MDP_DMA_S_IBUF_ADDR_ADDR A:0x1aa0008
y.create.l HWIO_MDSS_MDP_DMA_S_IBUF_Y_STRIDE_ADDR A:0x1aa000c
y.create.l HWIO_MDSS_MDP_DMA_S_OUT_XY_ADDR A:0x1aa0010
y.create.l HWIO_MDSS_MDP_DMA_S_LINE_COUNT_ADDR A:0x1aa0014
y.create.l HWIO_MDSS_MDP_DMA_S_LINE_IRQ_ADDR A:0x1aa0018
y.create.l HWIO_MDSS_MDP_DMA_S_MASK_PATTERN_ADDR A:0x1aa001c
y.create.l HWIO_MDSS_MDP_DMA_S_PROFILE_EN_ADDR A:0x1aa0020
y.create.l HWIO_MDSS_MDP_DMA_S_PROFILE_COUNT_ADDR A:0x1aa0024
y.create.l HWIO_MDSS_MDP_TEST_MODE_CLK_ADDR A:0x1ad0000
y.create.l HWIO_MDSS_MDP_TEST_MISR_RESET_CLK_ADDR A:0x1ad0004
y.create.l HWIO_MDSS_MDP_TEST_EXPORT_MISR_CLK_ADDR A:0x1ad0008
y.create.l HWIO_MDSS_MDP_TEST_MISR_CURR_VAL_CLK_ADDR A:0x1ad000c
y.create.l HWIO_MDSS_MDP_TEST_MODE_HCLK_ADDR A:0x1ad0100
y.create.l HWIO_MDSS_MDP_TEST_MISR_RESET_HCLK_ADDR A:0x1ad0104
y.create.l HWIO_MDSS_MDP_TEST_EXPORT_MISR_HCLK_ADDR A:0x1ad0108
y.create.l HWIO_MDSS_MDP_TEST_MISR_CURR_VAL_HCLK_ADDR A:0x1ad010c
y.create.l HWIO_MDSS_MDP_TEST_MODE_DCLK_ADDR A:0x1ad0200
y.create.l HWIO_MDSS_MDP_TEST_MISR_RESET_DCLK_ADDR A:0x1ad0204
y.create.l HWIO_MDSS_MDP_TEST_EXPORT_MISR_DCLK_ADDR A:0x1ad0208
y.create.l HWIO_MDSS_MDP_TEST_MISR_CURR_VAL_DCLK_ADDR A:0x1ad020c
y.create.l HWIO_MDSS_MDP_TEST_CAPTURED_DCLK_ADDR A:0x1ad0210
y.create.l HWIO_MDSS_MDP_TEST_MISR_CAPT_VAL_DCLK_ADDR A:0x1ad0214
y.create.l HWIO_MDSS_MDP_TEST_MODE_TVCLK_ADDR A:0x1ad0300
y.create.l HWIO_MDSS_MDP_TEST_MISR_RESET_TVCLK_ADDR A:0x1ad0304
y.create.l HWIO_MDSS_MDP_TEST_EXPORT_MISR_TVCLK_ADDR A:0x1ad0308
y.create.l HWIO_MDSS_MDP_TEST_MISR_CURR_VAL_TVCLK_ADDR A:0x1ad030c
y.create.l HWIO_MDSS_MDP_TEST_CAPTURED_TVCLK_ADDR A:0x1ad0310
y.create.l HWIO_MDSS_MDP_TEST_MISR_CAPT_VAL_TVCLK_ADDR A:0x1ad0314
y.create.l HWIO_MDSS_MDP_TEST_MODE_DSI_PCLK_ADDR A:0x1ad0400
y.create.l HWIO_MDSS_MDP_TEST_MISR_RESET_DSI_PCLK_ADDR A:0x1ad0404
y.create.l HWIO_MDSS_MDP_TEST_EXPORT_MISR_DSI_PCLK_ADDR A:0x1ad0408
y.create.l HWIO_MDSS_MDP_TEST_MISR_CURR_VAL_DSI_PCLK_ADDR A:0x1ad040c
y.create.l HWIO_MDSS_MDP_TEST_CAPTURED_DSI_PCLK_ADDR A:0x1ad0410
y.create.l HWIO_MDSS_MDP_TEST_MISR_CAPT_VAL_DSI_PCLK_ADDR A:0x1ad0414
y.create.l HWIO_MDSS_MDP_TEST_MISR_TESTBUS_CAPT_VAL_ADDR A:0x1ad0600
y.create.l HWIO_MDSS_MDP_LCDC_EN_ADDR A:0x1ae0000
y.create.l HWIO_MDSS_MDP_LCDC_HSYNC_CTL_ADDR A:0x1ae0004
y.create.l HWIO_MDSS_MDP_LCDC_VSYNC_PERIOD_ADDR A:0x1ae0008
y.create.l HWIO_MDSS_MDP_LCDC_VSYNC_PULSE_WIDTH_ADDR A:0x1ae000c
y.create.l HWIO_MDSS_MDP_LCDC_DISPLAY_HCTL_ADDR A:0x1ae0010
y.create.l HWIO_MDSS_MDP_LCDC_DISPLAY_V_START_ADDR A:0x1ae0014
y.create.l HWIO_MDSS_MDP_LCDC_DISPLAY_V_END_ADDR A:0x1ae0018
y.create.l HWIO_MDSS_MDP_LCDC_ACTIVE_HCTL_ADDR A:0x1ae001c
y.create.l HWIO_MDSS_MDP_LCDC_ACTIVE_V_START_ADDR A:0x1ae0020
y.create.l HWIO_MDSS_MDP_LCDC_ACTIVE_V_END_ADDR A:0x1ae0024
y.create.l HWIO_MDSS_MDP_LCDC_BORDER_CLR_ADDR A:0x1ae0028
y.create.l HWIO_MDSS_MDP_LCDC_UNDERFLOW_CTL_ADDR A:0x1ae002c
y.create.l HWIO_MDSS_MDP_LCDC_HSYNC_SKEW_ADDR A:0x1ae0030
y.create.l HWIO_MDSS_MDP_LCDC_TEST_CTL_ADDR A:0x1ae0034
y.create.l HWIO_MDSS_MDP_LCDC_CTL_POLARITY_ADDR A:0x1ae0038
y.create.l HWIO_MDSS_MDP_LCDC_TEST_COL_VAR1_ADDR A:0x1ae003c
y.create.l HWIO_MDSS_MDP_LCDC_TEST_COL_VAR2_ADDR A:0x1ae0040
y.create.l HWIO_MDSS_MDP_LCDC_UFLOW_HIDING_CTL_ADDR A:0x1ae0044
y.create.l HWIO_MDSS_MDP_LCDC_LOST_PIXEL_CNT_VALUE_ADDR A:0x1ae0048
y.create.l HWIO_MDSS_MDP_DSI_VIDEO_EN_ADDR A:0x1af0000
y.create.l HWIO_MDSS_MDP_DSI_VIDEO_HSYNC_CTL_ADDR A:0x1af0004
y.create.l HWIO_MDSS_MDP_DSI_VIDEO_VSYNC_PERIOD_ADDR A:0x1af0008
y.create.l HWIO_MDSS_MDP_DSI_VIDEO_VSYNC_PULSE_WIDTH_ADDR A:0x1af000c
y.create.l HWIO_MDSS_MDP_DSI_VIDEO_DISPLAY_HCTL_ADDR A:0x1af0010
y.create.l HWIO_MDSS_MDP_DSI_VIDEO_DISPLAY_V_START_ADDR A:0x1af0014
y.create.l HWIO_MDSS_MDP_DSI_VIDEO_DISPLAY_V_END_ADDR A:0x1af0018
y.create.l HWIO_MDSS_MDP_DSI_VIDEO_ACTIVE_HCTL_ADDR A:0x1af001c
y.create.l HWIO_MDSS_MDP_DSI_VIDEO_ACTIVE_V_START_ADDR A:0x1af0020
y.create.l HWIO_MDSS_MDP_DSI_VIDEO_ACTIVE_V_END_ADDR A:0x1af0024
y.create.l HWIO_MDSS_MDP_DSI_VIDEO_BORDER_CLR_ADDR A:0x1af0028
y.create.l HWIO_MDSS_MDP_DSI_VIDEO_UNDERFLOW_CTL_ADDR A:0x1af002c
y.create.l HWIO_MDSS_MDP_DSI_VIDEO_HSYNC_SKEW_ADDR A:0x1af0030
y.create.l HWIO_MDSS_MDP_DSI_VIDEO_TEST_CTL_ADDR A:0x1af0034
y.create.l HWIO_MDSS_MDP_DSI_VIDEO_CTL_POLARITY_ADDR A:0x1af0038
y.create.l HWIO_MDSS_MDP_DSI_VIDEO_TEST_COL_VAR1_ADDR A:0x1af003c
y.create.l HWIO_MDSS_MDP_DSI_VIDEO_TEST_COL_VAR2_ADDR A:0x1af0040
y.create.l HWIO_MDSS_MDP_DSI_VIDEO_UFLOW_HIDING_CTL_ADDR A:0x1af0044
y.create.l HWIO_MDSS_MDP_DSI_VIDEO_LOST_PIXEL_CNT_VALUE_ADDR A:0x1af0048
y.create.l HWIO_MDSS_MDP_DSI_CMD_MODE_ID_MAP_ADDR A:0x1af1000
y.create.l HWIO_MDSS_MDP_DSI_CMD_MODE_TRIGGER_EN_ADDR A:0x1af1004
y.create.l HWIO_MDSS_DSI_0_HW_VERSION_ADDR A:0x1ac8000
y.create.l HWIO_MDSS_DSI_0_CTRL_ADDR A:0x1ac8004
y.create.l HWIO_MDSS_DSI_0_STATUS_ADDR A:0x1ac8008
y.create.l HWIO_MDSS_DSI_0_FIFO_STATUS_ADDR A:0x1ac800c
y.create.l HWIO_MDSS_DSI_0_VIDEO_MODE_CTRL_ADDR A:0x1ac8010
y.create.l HWIO_MDSS_DSI_0_VIDEO_MODE_SYNC_DATATYPE_ADDR A:0x1ac8014
y.create.l HWIO_MDSS_DSI_0_VIDEO_MODE_PIXEL_DATATYPE_ADDR A:0x1ac8018
y.create.l HWIO_MDSS_DSI_0_VIDEO_MODE_BLANKING_DATATYPE_ADDR A:0x1ac801c
y.create.l HWIO_MDSS_DSI_0_VIDEO_MODE_DATA_CTRL_ADDR A:0x1ac8020
y.create.l HWIO_MDSS_DSI_0_VIDEO_MODE_ACTIVE_H_ADDR A:0x1ac8024
y.create.l HWIO_MDSS_DSI_0_VIDEO_MODE_ACTIVE_V_ADDR A:0x1ac8028
y.create.l HWIO_MDSS_DSI_0_VIDEO_MODE_TOTAL_ADDR A:0x1ac802c
y.create.l HWIO_MDSS_DSI_0_VIDEO_MODE_HSYNC_ADDR A:0x1ac8030
y.create.l HWIO_MDSS_DSI_0_VIDEO_MODE_VSYNC_ADDR A:0x1ac8034
y.create.l HWIO_MDSS_DSI_0_VIDEO_MODE_VSYNC_VPOS_ADDR A:0x1ac8038
y.create.l HWIO_MDSS_DSI_0_COMMAND_MODE_DMA_CTRL_ADDR A:0x1ac803c
y.create.l HWIO_MDSS_DSI_0_COMMAND_MODE_MDP_CTRL_ADDR A:0x1ac8040
y.create.l HWIO_MDSS_DSI_0_COMMAND_MODE_MDP_DCS_CMD_CTRL_ADDR A:0x1ac8044
y.create.l HWIO_MDSS_DSI_0_DMA_CMD_OFFSET_ADDR A:0x1ac8048
y.create.l HWIO_MDSS_DSI_0_DMA_CMD_LENGTH_ADDR A:0x1ac804c
y.create.l HWIO_MDSS_DSI_0_DMA_FIFO_CTRL_ADDR A:0x1ac8050
y.create.l HWIO_MDSS_DSI_0_DMA_NULL_PACKET_DATA_ADDR A:0x1ac8054
y.create.l HWIO_MDSS_DSI_0_COMMAND_MODE_MDP_STREAM0_CTRL_ADDR A:0x1ac8058
y.create.l HWIO_MDSS_DSI_0_COMMAND_MODE_MDP_STREAM0_TOTAL_ADDR A:0x1ac805c
y.create.l HWIO_MDSS_DSI_0_COMMAND_MODE_MDP_STREAM1_CTRL_ADDR A:0x1ac8060
y.create.l HWIO_MDSS_DSI_0_COMMAND_MODE_MDP_STREAM1_TOTAL_ADDR A:0x1ac8064
y.create.l HWIO_MDSS_DSI_0_ACK_ERR_STATUS_ADDR A:0x1ac8068
y.create.l HWIO_MDSS_DSI_0_RDBK_DATA0_ADDR A:0x1ac806c
y.create.l HWIO_MDSS_DSI_0_RDBK_DATA1_ADDR A:0x1ac8070
y.create.l HWIO_MDSS_DSI_0_RDBK_DATA2_ADDR A:0x1ac8074
y.create.l HWIO_MDSS_DSI_0_RDBK_DATA3_ADDR A:0x1ac8078
y.create.l HWIO_MDSS_DSI_0_RDBK_DATATYPE0_ADDR A:0x1ac807c
y.create.l HWIO_MDSS_DSI_0_RDBK_DATATYPE1_ADDR A:0x1ac8080
y.create.l HWIO_MDSS_DSI_0_TRIG_CTRL_ADDR A:0x1ac8084
y.create.l HWIO_MDSS_DSI_0_EXT_MUX_ADDR A:0x1ac8088
y.create.l HWIO_MDSS_DSI_0_EXT_TE_PULSE_DETECT_CTRL_ADDR A:0x1ac808c
y.create.l HWIO_MDSS_DSI_0_CMD_MODE_DMA_SW_TRIGGER_ADDR A:0x1ac8090
y.create.l HWIO_MDSS_DSI_0_CMD_MODE_MDP_SW_TRIGGER_ADDR A:0x1ac8094
y.create.l HWIO_MDSS_DSI_0_CMD_MODE_BTA_SW_TRIGGER_ADDR A:0x1ac8098
y.create.l HWIO_MDSS_DSI_0_RESET_SW_TRIGGER_ADDR A:0x1ac809c
y.create.l HWIO_MDSS_DSI_0_MISR_CMD_CTRL_ADDR A:0x1ac80a0
y.create.l HWIO_MDSS_DSI_0_MISR_VIDEO_CTRL_ADDR A:0x1ac80a4
y.create.l HWIO_MDSS_DSI_0_LANE_STATUS_ADDR A:0x1ac80a8
y.create.l HWIO_MDSS_DSI_0_LANE_CTRL_ADDR A:0x1ac80ac
y.create.l HWIO_MDSS_DSI_0_LANE_SWAP_CTRL_ADDR A:0x1ac80b0
y.create.l HWIO_MDSS_DSI_0_DLN0_PHY_ERR_ADDR A:0x1ac80b4
y.create.l HWIO_MDSS_DSI_0_LP_TIMER_CTRL_ADDR A:0x1ac80b8
y.create.l HWIO_MDSS_DSI_0_HS_TIMER_CTRL_ADDR A:0x1ac80bc
y.create.l HWIO_MDSS_DSI_0_TIMEOUT_STATUS_ADDR A:0x1ac80c0
y.create.l HWIO_MDSS_DSI_0_CLKOUT_TIMING_CTRL_ADDR A:0x1ac80c4
y.create.l HWIO_MDSS_DSI_0_EOT_PACKET_ADDR A:0x1ac80c8
y.create.l HWIO_MDSS_DSI_0_EOT_PACKET_CTRL_ADDR A:0x1ac80cc
y.create.l HWIO_MDSS_DSI_0_GENERIC_ESC_TX_TRIGGER_ADDR A:0x1ac80d0
y.create.l HWIO_MDSS_DSI_0_CAM_BIST_CTRL_ADDR A:0x1ac80d4
y.create.l HWIO_MDSS_DSI_0_CAM_BIST_FRAME_SIZE_ADDR A:0x1ac80d8
y.create.l HWIO_MDSS_DSI_0_CAM_BIST_BLOCK_SIZE_ADDR A:0x1ac80dc
y.create.l HWIO_MDSS_DSI_0_CAM_BIST_FRAME_CONFIG_ADDR A:0x1ac80e0
y.create.l HWIO_MDSS_DSI_0_CAM_BIST_LSFR_CTRL_ADDR A:0x1ac80e4
y.create.l HWIO_MDSS_DSI_0_CAM_BIST_LSFR_INIT_ADDR A:0x1ac80e8
y.create.l HWIO_MDSS_DSI_0_CAM_BIST_START_ADDR A:0x1ac80ec
y.create.l HWIO_MDSS_DSI_0_CAM_BIST_STATUS_ADDR A:0x1ac80f0
y.create.l HWIO_MDSS_DSI_0_ERR_INT_MASK0_ADDR A:0x1ac810c
y.create.l HWIO_MDSS_DSI_0_INT_CTRL_ADDR A:0x1ac8110
y.create.l HWIO_MDSS_DSI_0_IOBIST_CTRL_ADDR A:0x1ac8114
y.create.l HWIO_MDSS_DSI_0_SOFT_RESET_ADDR A:0x1ac8118
y.create.l HWIO_MDSS_DSI_0_CLK_CTRL_ADDR A:0x1ac811c
y.create.l HWIO_MDSS_DSI_0_CLK_STATUS_ADDR A:0x1ac8120
y.create.l HWIO_MDSS_DSI_0_DEBUG_BUS_CTRL_ADDR A:0x1ac8124
y.create.l HWIO_MDSS_DSI_0_DEBUG_BUS_ADDR A:0x1ac8128
y.create.l HWIO_MDSS_DSI_0_PHY_SW_RESET_ADDR A:0x1ac812c
y.create.l HWIO_MDSS_DSI_0_AXI2AHB_CTRL_ADDR A:0x1ac8130
y.create.l HWIO_MDSS_DSI_0_MISR_CMD_MDP0_32BIT_ADDR A:0x1ac8134
y.create.l HWIO_MDSS_DSI_0_MISR_CMD_MDP1_32BIT_ADDR A:0x1ac8138
y.create.l HWIO_MDSS_DSI_0_MISR_CMD_DMA_32BIT_ADDR A:0x1ac813c
y.create.l HWIO_MDSS_DSI_0_MISR_VIDEO_32BIT_ADDR A:0x1ac8140
y.create.l HWIO_MDSS_DSI_0_LANE_MISR_CTRL_ADDR A:0x1ac8144
y.create.l HWIO_MDSS_DSI_0_LANE0_MISR_ADDR A:0x1ac8148
y.create.l HWIO_MDSS_DSI_0_LANE1_MISR_ADDR A:0x1ac814c
y.create.l HWIO_MDSS_DSI_0_LANE2_MISR_ADDR A:0x1ac8150
y.create.l HWIO_MDSS_DSI_0_LANE3_MISR_ADDR A:0x1ac8154
y.create.l HWIO_MDSS_DSI_0_TEST_PATTERN_GEN_CTRL_ADDR A:0x1ac815c
y.create.l HWIO_MDSS_DSI_0_TEST_PATTERN_GEN_VIDEO_POLY_ADDR A:0x1ac8160
y.create.l HWIO_MDSS_DSI_0_TEST_PATTERN_GEN_VIDEO_INIT_VAL_ADDR A:0x1ac8164
y.create.l HWIO_MDSS_DSI_0_TEST_PATTERN_GEN_CMD_MDP_STREAM0_POLY_ADDR A:0x1ac8168
y.create.l HWIO_MDSS_DSI_0_TEST_PATTERN_GEN_CMD_MDP_INIT_VAL0_ADDR A:0x1ac816c
y.create.l HWIO_MDSS_DSI_0_TEST_PATTERN_GEN_CMD_MDP_STREAM1_POLY_ADDR A:0x1ac8170
y.create.l HWIO_MDSS_DSI_0_TEST_PATTERN_GEN_CMD_MDP_INIT_VAL1_ADDR A:0x1ac8174
y.create.l HWIO_MDSS_DSI_0_TEST_PATTERN_GEN_CMD_DMA_POLY_ADDR A:0x1ac8178
y.create.l HWIO_MDSS_DSI_0_TEST_PATTERN_GEN_CMD_DMA_INIT_VAL_ADDR A:0x1ac817c
y.create.l HWIO_MDSS_DSI_0_TEST_PATTERN_GEN_VIDEO_ENABLE_ADDR A:0x1ac8180
y.create.l HWIO_MDSS_DSI_0_TEST_PATTERN_GEN_CMD_STREAM0_TRIGGER_ADDR A:0x1ac8184
y.create.l HWIO_MDSS_DSI_0_TEST_PATTERN_GEN_CMD_STREAM1_TRIGGER_ADDR A:0x1ac8188
y.create.l HWIO_MDSS_DSI_0_TEST_PATTERN_GEN_CMD_MDP_INIT_VAL2_ADDR A:0x1ac818c
y.create.l HWIO_MDSS_DSI_0_TEST_PATTERN_GEN_CMD_MDP_STREAM2_POLY_ADDR A:0x1ac8190
y.create.l HWIO_MDSS_DSI_0_COMMAND_MODE_MDP_IDLE_CTRL_ADDR A:0x1ac8194
y.create.l HWIO_MDSS_DSI_0_TEST_PATTERN_GEN_CMD_STREAM2_TRIGGER_ADDR A:0x1ac8198
y.create.l HWIO_MDSS_DSI_0_TPG_MAIN_CONTROL_ADDR A:0x1ac819c
y.create.l HWIO_MDSS_DSI_0_TPG_MAIN_CONTROL2_ADDR A:0x1ac81a0
y.create.l HWIO_MDSS_DSI_0_TPG_VIDEO_CONFIG_ADDR A:0x1ac81a4
y.create.l HWIO_MDSS_DSI_0_TPG_COMPONENT_LIMITS_ADDR A:0x1ac81a8
y.create.l HWIO_MDSS_DSI_0_TPG_RECTANGLE_ADDR A:0x1ac81ac
y.create.l HWIO_MDSS_DSI_0_TPG_BLACK_WHITE_PATTERN_FRAMES_ADDR A:0x1ac81b0
y.create.l HWIO_MDSS_DSI_0_TPG_RGB_MAPPING_ADDR A:0x1ac81b4
y.create.l HWIO_MDSS_DSI_0_COMMAND_MODE_MDP_CTRL2_ADDR A:0x1ac81b8
y.create.l HWIO_MDSS_DSI_0_COMMAND_MODE_MDP_STREAM2_CTRL_ADDR A:0x1ac81bc
y.create.l HWIO_MDSS_DSI_0_COMMAND_MODE_MDP_STREAM2_TOTAL_ADDR A:0x1ac81c0
y.create.l HWIO_MDSS_DSI_0_MISR_CMD_MDP2_8BIT_ADDR A:0x1ac81c4
y.create.l HWIO_MDSS_DSI_0_MISR_CMD_MDP2_32BIT_ADDR A:0x1ac81c8
y.create.l HWIO_MDSS_DSI_0_VBIF_CTRL_ADDR A:0x1ac81cc
y.create.l HWIO_MDSS_DSI_0_AES_CTRL_ADDR A:0x1ac81d0
y.create.l HWIO_MDSS_DSI_0_RDBK_DATA_CTRL_ADDR A:0x1ac81d4
y.create.l HWIO_MDSS_DSI_0_TEST_PATTERN_GEN_CMD_DMA_INIT_VAL2_ADDR A:0x1ac81d8
y.create.l HWIO_MDSS_DSI_0_TPG_DMA_FIFO_STATUS_ADDR A:0x1ac81dc
y.create.l HWIO_MDSS_DSI_0_TPG_DMA_FIFO_WRITE_TRIGGER_ADDR A:0x1ac81e0
y.create.l HWIO_MDSS_DSI_0_DSI_TIMING_FLUSH_ADDR A:0x1ac81e4
y.create.l HWIO_MDSS_DSI_0_DSI_TIMING_DB_MODE_ADDR A:0x1ac81e8
y.create.l HWIO_MDSS_DSI_0_TPG_DMA_FIFO_RESET_ADDR A:0x1ac81ec
y.create.l HWIO_MDSS_DSI_0_SCRATCH_REGISTER_0_ADDR A:0x1ac81f0
y.create.l HWIO_MDSS_DSI_0_VERSION_ADDR A:0x1ac81f4
y.create.l HWIO_MDSS_DSI_0_SCRATCH_REGISTER_1_ADDR A:0x1ac81f8
y.create.l HWIO_MDSS_DSI_0_SCRATCH_REGISTER_2_ADDR A:0x1ac81fc
y.create.l HWIO_MDSS_DSI_0_DYNAMIC_REFRESH_CTRL_ADDR A:0x1ac8200
y.create.l HWIO_MDSS_DSI_0_DYNAMIC_REFRESH_PIPE_DELAY_ADDR A:0x1ac8204
y.create.l HWIO_MDSS_DSI_0_DYNAMIC_REFRESH_PIPE_DELAY2_ADDR A:0x1ac8208
y.create.l HWIO_MDSS_DSI_0_DYNAMIC_REFRESH_PLL_DELAY_ADDR A:0x1ac820c
y.create.l HWIO_MDSS_DSI_0_DYNAMIC_REFRESH_STATUS_ADDR A:0x1ac8210
y.create.l HWIO_MDSS_DSI_0_DYNAMIC_REFRESH_PLL_CTRL0_ADDR A:0x1ac8214
y.create.l HWIO_MDSS_DSI_0_DYNAMIC_REFRESH_PLL_CTRL1_ADDR A:0x1ac8218
y.create.l HWIO_MDSS_DSI_0_DYNAMIC_REFRESH_PLL_CTRL2_ADDR A:0x1ac821c
y.create.l HWIO_MDSS_DSI_0_DYNAMIC_REFRESH_PLL_CTRL3_ADDR A:0x1ac8220
y.create.l HWIO_MDSS_DSI_0_DYNAMIC_REFRESH_PLL_CTRL4_ADDR A:0x1ac8224
y.create.l HWIO_MDSS_DSI_0_DYNAMIC_REFRESH_PLL_CTRL5_ADDR A:0x1ac8228
y.create.l HWIO_MDSS_DSI_0_DYNAMIC_REFRESH_PLL_CTRL6_ADDR A:0x1ac822c
y.create.l HWIO_MDSS_DSI_0_DYNAMIC_REFRESH_PLL_CTRL7_ADDR A:0x1ac8230
y.create.l HWIO_MDSS_DSI_0_DYNAMIC_REFRESH_PLL_CTRL8_ADDR A:0x1ac8234
y.create.l HWIO_MDSS_DSI_0_DYNAMIC_REFRESH_PLL_CTRL9_ADDR A:0x1ac8238
y.create.l HWIO_MDSS_DSI_0_DYNAMIC_REFRESH_PLL_CTRL10_ADDR A:0x1ac823c
y.create.l HWIO_MDSS_DSI_0_DYNAMIC_REFRESH_PLL_CTRL11_ADDR A:0x1ac8240
y.create.l HWIO_MDSS_DSI_0_DYNAMIC_REFRESH_PLL_CTRL12_ADDR A:0x1ac8244
y.create.l HWIO_MDSS_DSI_0_DYNAMIC_REFRESH_PLL_CTRL13_ADDR A:0x1ac8248
y.create.l HWIO_MDSS_DSI_0_DYNAMIC_REFRESH_PLL_CTRL14_ADDR A:0x1ac824c
y.create.l HWIO_MDSS_DSI_0_DYNAMIC_REFRESH_PLL_CTRL15_ADDR A:0x1ac8250
y.create.l HWIO_MDSS_DSI_0_DYNAMIC_REFRESH_PLL_CTRL16_ADDR A:0x1ac8254
y.create.l HWIO_MDSS_DSI_0_DYNAMIC_REFRESH_PLL_CTRL17_ADDR A:0x1ac8258
y.create.l HWIO_MDSS_DSI_0_PHY_PLL_UNIPHY_PLL_REFCLK_CFG_ADDR A:0x1ac8300
y.create.l HWIO_MDSS_DSI_0_PHY_PLL_UNIPHY_PLL_POSTDIV1_CFG_ADDR A:0x1ac8304
y.create.l HWIO_MDSS_DSI_0_PHY_PLL_UNIPHY_PLL_CHGPUMP_CFG_ADDR A:0x1ac8308
y.create.l HWIO_MDSS_DSI_0_PHY_PLL_UNIPHY_PLL_VCOLPF_CFG_ADDR A:0x1ac830c
y.create.l HWIO_MDSS_DSI_0_PHY_PLL_UNIPHY_PLL_VREG_CFG_ADDR A:0x1ac8310
y.create.l HWIO_MDSS_DSI_0_PHY_PLL_UNIPHY_PLL_PWRGEN_CFG_ADDR A:0x1ac8314
y.create.l HWIO_MDSS_DSI_0_PHY_PLL_UNIPHY_PLL_DMUX_CFG_ADDR A:0x1ac8318
y.create.l HWIO_MDSS_DSI_0_PHY_PLL_UNIPHY_PLL_AMUX_CFG_ADDR A:0x1ac831c
y.create.l HWIO_MDSS_DSI_0_PHY_PLL_UNIPHY_PLL_GLB_CFG_ADDR A:0x1ac8320
y.create.l HWIO_MDSS_DSI_0_PHY_PLL_UNIPHY_PLL_POSTDIV2_CFG_ADDR A:0x1ac8324
y.create.l HWIO_MDSS_DSI_0_PHY_PLL_UNIPHY_PLL_POSTDIV3_CFG_ADDR A:0x1ac8328
y.create.l HWIO_MDSS_DSI_0_PHY_PLL_UNIPHY_PLL_LPFR_CFG_ADDR A:0x1ac832c
y.create.l HWIO_MDSS_DSI_0_PHY_PLL_UNIPHY_PLL_LPFC1_CFG_ADDR A:0x1ac8330
y.create.l HWIO_MDSS_DSI_0_PHY_PLL_UNIPHY_PLL_LPFC2_CFG_ADDR A:0x1ac8334
y.create.l HWIO_MDSS_DSI_0_PHY_PLL_UNIPHY_PLL_SDM_CFG0_ADDR A:0x1ac8338
y.create.l HWIO_MDSS_DSI_0_PHY_PLL_UNIPHY_PLL_SDM_CFG1_ADDR A:0x1ac833c
y.create.l HWIO_MDSS_DSI_0_PHY_PLL_UNIPHY_PLL_SDM_CFG2_ADDR A:0x1ac8340
y.create.l HWIO_MDSS_DSI_0_PHY_PLL_UNIPHY_PLL_SDM_CFG3_ADDR A:0x1ac8344
y.create.l HWIO_MDSS_DSI_0_PHY_PLL_UNIPHY_PLL_SDM_CFG4_ADDR A:0x1ac8348
y.create.l HWIO_MDSS_DSI_0_PHY_PLL_UNIPHY_PLL_SSC_CFG0_ADDR A:0x1ac834c
y.create.l HWIO_MDSS_DSI_0_PHY_PLL_UNIPHY_PLL_SSC_CFG1_ADDR A:0x1ac8350
y.create.l HWIO_MDSS_DSI_0_PHY_PLL_UNIPHY_PLL_SSC_CFG2_ADDR A:0x1ac8354
y.create.l HWIO_MDSS_DSI_0_PHY_PLL_UNIPHY_PLL_SSC_CFG3_ADDR A:0x1ac8358
y.create.l HWIO_MDSS_DSI_0_PHY_PLL_UNIPHY_PLL_LKDET_CFG0_ADDR A:0x1ac835c
y.create.l HWIO_MDSS_DSI_0_PHY_PLL_UNIPHY_PLL_LKDET_CFG1_ADDR A:0x1ac8360
y.create.l HWIO_MDSS_DSI_0_PHY_PLL_UNIPHY_PLL_LKDET_CFG2_ADDR A:0x1ac8364
y.create.l HWIO_MDSS_DSI_0_PHY_PLL_UNIPHY_PLL_TEST_CFG_ADDR A:0x1ac8368
y.create.l HWIO_MDSS_DSI_0_PHY_PLL_UNIPHY_PLL_CAL_CFG0_ADDR A:0x1ac836c
y.create.l HWIO_MDSS_DSI_0_PHY_PLL_UNIPHY_PLL_CAL_CFG1_ADDR A:0x1ac8370
y.create.l HWIO_MDSS_DSI_0_PHY_PLL_UNIPHY_PLL_CAL_CFG2_ADDR A:0x1ac8374
y.create.l HWIO_MDSS_DSI_0_PHY_PLL_UNIPHY_PLL_CAL_CFG3_ADDR A:0x1ac8378
y.create.l HWIO_MDSS_DSI_0_PHY_PLL_UNIPHY_PLL_CAL_CFG4_ADDR A:0x1ac837c
y.create.l HWIO_MDSS_DSI_0_PHY_PLL_UNIPHY_PLL_CAL_CFG5_ADDR A:0x1ac8380
y.create.l HWIO_MDSS_DSI_0_PHY_PLL_UNIPHY_PLL_CAL_CFG6_ADDR A:0x1ac8384
y.create.l HWIO_MDSS_DSI_0_PHY_PLL_UNIPHY_PLL_CAL_CFG7_ADDR A:0x1ac8388
y.create.l HWIO_MDSS_DSI_0_PHY_PLL_UNIPHY_PLL_CAL_CFG8_ADDR A:0x1ac838c
y.create.l HWIO_MDSS_DSI_0_PHY_PLL_UNIPHY_PLL_CAL_CFG9_ADDR A:0x1ac8390
y.create.l HWIO_MDSS_DSI_0_PHY_PLL_UNIPHY_PLL_CAL_CFG10_ADDR A:0x1ac8394
y.create.l HWIO_MDSS_DSI_0_PHY_PLL_UNIPHY_PLL_CAL_CFG11_ADDR A:0x1ac8398
y.create.l HWIO_MDSS_DSI_0_PHY_PLL_UNIPHY_PLL_EFUSE_CFG_ADDR A:0x1ac839c
y.create.l HWIO_MDSS_DSI_0_PHY_PLL_UNIPHY_PLL_DEBUG_BUS_SEL_ADDR A:0x1ac83a0
y.create.l HWIO_MDSS_DSI_0_PHY_PLL_UNIPHY_PLL_CTRL_42_ADDR A:0x1ac83a4
y.create.l HWIO_MDSS_DSI_0_PHY_PLL_UNIPHY_PLL_CTRL_43_ADDR A:0x1ac83a8
y.create.l HWIO_MDSS_DSI_0_PHY_PLL_UNIPHY_PLL_CTRL_44_ADDR A:0x1ac83ac
y.create.l HWIO_MDSS_DSI_0_PHY_PLL_UNIPHY_PLL_CTRL_45_ADDR A:0x1ac83b0
y.create.l HWIO_MDSS_DSI_0_PHY_PLL_UNIPHY_PLL_CTRL_46_ADDR A:0x1ac83b4
y.create.l HWIO_MDSS_DSI_0_PHY_PLL_UNIPHY_PLL_CTRL_47_ADDR A:0x1ac83b8
y.create.l HWIO_MDSS_DSI_0_PHY_PLL_UNIPHY_PLL_CTRL_48_ADDR A:0x1ac83bc
y.create.l HWIO_MDSS_DSI_0_PHY_PLL_UNIPHY_PLL_STATUS_ADDR A:0x1ac83c0
y.create.l HWIO_MDSS_DSI_0_PHY_PLL_UNIPHY_PLL_DEBUG_BUS0_ADDR A:0x1ac83c4
y.create.l HWIO_MDSS_DSI_0_PHY_PLL_UNIPHY_PLL_DEBUG_BUS1_ADDR A:0x1ac83c8
y.create.l HWIO_MDSS_DSI_0_PHY_PLL_UNIPHY_PLL_DEBUG_BUS2_ADDR A:0x1ac83cc
y.create.l HWIO_MDSS_DSI_0_PHY_PLL_UNIPHY_PLL_DEBUG_BUS3_ADDR A:0x1ac83d0
y.create.l HWIO_MDSS_DSI_0_PHY_PLL_UNIPHY_PLL_CTRL_54_ADDR A:0x1ac83d4
y.create.l HWIO_MDSS_DSI_0_PHY_DSIPHY_LN0_CFG0_ADDR A:0x1ac8500
y.create.l HWIO_MDSS_DSI_0_PHY_DSIPHY_LN1_CFG0_ADDR A:0x1ac8540
y.create.l HWIO_MDSS_DSI_0_PHY_DSIPHY_LN2_CFG0_ADDR A:0x1ac8580
y.create.l HWIO_MDSS_DSI_0_PHY_DSIPHY_LN3_CFG0_ADDR A:0x1ac85c0
y.create.l HWIO_MDSS_DSI_0_PHY_DSIPHY_LN0_CFG1_ADDR A:0x1ac8504
y.create.l HWIO_MDSS_DSI_0_PHY_DSIPHY_LN1_CFG1_ADDR A:0x1ac8544
y.create.l HWIO_MDSS_DSI_0_PHY_DSIPHY_LN2_CFG1_ADDR A:0x1ac8584
y.create.l HWIO_MDSS_DSI_0_PHY_DSIPHY_LN3_CFG1_ADDR A:0x1ac85c4
y.create.l HWIO_MDSS_DSI_0_PHY_DSIPHY_LN0_CFG2_ADDR A:0x1ac8508
y.create.l HWIO_MDSS_DSI_0_PHY_DSIPHY_LN1_CFG2_ADDR A:0x1ac8548
y.create.l HWIO_MDSS_DSI_0_PHY_DSIPHY_LN2_CFG2_ADDR A:0x1ac8588
y.create.l HWIO_MDSS_DSI_0_PHY_DSIPHY_LN3_CFG2_ADDR A:0x1ac85c8
y.create.l HWIO_MDSS_DSI_0_PHY_DSIPHY_LN0_CFG3_ADDR A:0x1ac850c
y.create.l HWIO_MDSS_DSI_0_PHY_DSIPHY_LN1_CFG3_ADDR A:0x1ac854c
y.create.l HWIO_MDSS_DSI_0_PHY_DSIPHY_LN2_CFG3_ADDR A:0x1ac858c
y.create.l HWIO_MDSS_DSI_0_PHY_DSIPHY_LN3_CFG3_ADDR A:0x1ac85cc
y.create.l HWIO_MDSS_DSI_0_PHY_DSIPHY_LN0_CFG4_ADDR A:0x1ac8510
y.create.l HWIO_MDSS_DSI_0_PHY_DSIPHY_LN1_CFG4_ADDR A:0x1ac8550
y.create.l HWIO_MDSS_DSI_0_PHY_DSIPHY_LN2_CFG4_ADDR A:0x1ac8590
y.create.l HWIO_MDSS_DSI_0_PHY_DSIPHY_LN3_CFG4_ADDR A:0x1ac85d0
y.create.l HWIO_MDSS_DSI_0_PHY_DSIPHY_LN0_TEST_DATAPATH_ADDR A:0x1ac8514
y.create.l HWIO_MDSS_DSI_0_PHY_DSIPHY_LN1_TEST_DATAPATH_ADDR A:0x1ac8554
y.create.l HWIO_MDSS_DSI_0_PHY_DSIPHY_LN2_TEST_DATAPATH_ADDR A:0x1ac8594
y.create.l HWIO_MDSS_DSI_0_PHY_DSIPHY_LN3_TEST_DATAPATH_ADDR A:0x1ac85d4
y.create.l HWIO_MDSS_DSI_0_PHY_DSIPHY_LN0_DEBUG_SEL_ADDR A:0x1ac8518
y.create.l HWIO_MDSS_DSI_0_PHY_DSIPHY_LN1_DEBUG_SEL_ADDR A:0x1ac8558
y.create.l HWIO_MDSS_DSI_0_PHY_DSIPHY_LN2_DEBUG_SEL_ADDR A:0x1ac8598
y.create.l HWIO_MDSS_DSI_0_PHY_DSIPHY_LN3_DEBUG_SEL_ADDR A:0x1ac85d8
y.create.l HWIO_MDSS_DSI_0_PHY_DSIPHY_LN0_TEST_STR0_ADDR A:0x1ac851c
y.create.l HWIO_MDSS_DSI_0_PHY_DSIPHY_LN1_TEST_STR0_ADDR A:0x1ac855c
y.create.l HWIO_MDSS_DSI_0_PHY_DSIPHY_LN2_TEST_STR0_ADDR A:0x1ac859c
y.create.l HWIO_MDSS_DSI_0_PHY_DSIPHY_LN3_TEST_STR0_ADDR A:0x1ac85dc
y.create.l HWIO_MDSS_DSI_0_PHY_DSIPHY_LN0_TEST_STR1_ADDR A:0x1ac8520
y.create.l HWIO_MDSS_DSI_0_PHY_DSIPHY_LN1_TEST_STR1_ADDR A:0x1ac8560
y.create.l HWIO_MDSS_DSI_0_PHY_DSIPHY_LN2_TEST_STR1_ADDR A:0x1ac85a0
y.create.l HWIO_MDSS_DSI_0_PHY_DSIPHY_LN3_TEST_STR1_ADDR A:0x1ac85e0
y.create.l HWIO_MDSS_DSI_0_PHY_DSIPHY_LN0_BIST_CTL0_ADDR A:0x1ac8524
y.create.l HWIO_MDSS_DSI_0_PHY_DSIPHY_LN1_BIST_CTL0_ADDR A:0x1ac8564
y.create.l HWIO_MDSS_DSI_0_PHY_DSIPHY_LN2_BIST_CTL0_ADDR A:0x1ac85a4
y.create.l HWIO_MDSS_DSI_0_PHY_DSIPHY_LN3_BIST_CTL0_ADDR A:0x1ac85e4
y.create.l HWIO_MDSS_DSI_0_PHY_DSIPHY_LN0_BIST_CTL1_ADDR A:0x1ac8528
y.create.l HWIO_MDSS_DSI_0_PHY_DSIPHY_LN1_BIST_CTL1_ADDR A:0x1ac8568
y.create.l HWIO_MDSS_DSI_0_PHY_DSIPHY_LN2_BIST_CTL1_ADDR A:0x1ac85a8
y.create.l HWIO_MDSS_DSI_0_PHY_DSIPHY_LN3_BIST_CTL1_ADDR A:0x1ac85e8
y.create.l HWIO_MDSS_DSI_0_PHY_DSIPHY_LN0_BIST_RXCHK_STATUS_ADDR A:0x1ac852c
y.create.l HWIO_MDSS_DSI_0_PHY_DSIPHY_LN1_BIST_RXCHK_STATUS_ADDR A:0x1ac856c
y.create.l HWIO_MDSS_DSI_0_PHY_DSIPHY_LN2_BIST_RXCHK_STATUS_ADDR A:0x1ac85ac
y.create.l HWIO_MDSS_DSI_0_PHY_DSIPHY_LN3_BIST_RXCHK_STATUS_ADDR A:0x1ac85ec
y.create.l HWIO_MDSS_DSI_0_PHY_DSIPHY_LN0_HSTX_STR_STATUS_ADDR A:0x1ac8530
y.create.l HWIO_MDSS_DSI_0_PHY_DSIPHY_LN1_HSTX_STR_STATUS_ADDR A:0x1ac8570
y.create.l HWIO_MDSS_DSI_0_PHY_DSIPHY_LN2_HSTX_STR_STATUS_ADDR A:0x1ac85b0
y.create.l HWIO_MDSS_DSI_0_PHY_DSIPHY_LN3_HSTX_STR_STATUS_ADDR A:0x1ac85f0
y.create.l HWIO_MDSS_DSI_0_PHY_RSVD_1_PHY_LN0_ADDR A:0x1ac8534
y.create.l HWIO_MDSS_DSI_0_PHY_RSVD_1_PHY_LN1_ADDR A:0x1ac8574
y.create.l HWIO_MDSS_DSI_0_PHY_RSVD_1_PHY_LN2_ADDR A:0x1ac85b4
y.create.l HWIO_MDSS_DSI_0_PHY_RSVD_1_PHY_LN3_ADDR A:0x1ac85f4
y.create.l HWIO_MDSS_DSI_0_PHY_DSIPHY_LN0_BIST_MISR_STAT0_ADDR A:0x1ac8538
y.create.l HWIO_MDSS_DSI_0_PHY_DSIPHY_LN1_BIST_MISR_STAT0_ADDR A:0x1ac8578
y.create.l HWIO_MDSS_DSI_0_PHY_DSIPHY_LN2_BIST_MISR_STAT0_ADDR A:0x1ac85b8
y.create.l HWIO_MDSS_DSI_0_PHY_DSIPHY_LN3_BIST_MISR_STAT0_ADDR A:0x1ac85f8
y.create.l HWIO_MDSS_DSI_0_PHY_DSIPHY_LN0_BIST_MISR_STAT1_ADDR A:0x1ac853c
y.create.l HWIO_MDSS_DSI_0_PHY_DSIPHY_LN1_BIST_MISR_STAT1_ADDR A:0x1ac857c
y.create.l HWIO_MDSS_DSI_0_PHY_DSIPHY_LN2_BIST_MISR_STAT1_ADDR A:0x1ac85bc
y.create.l HWIO_MDSS_DSI_0_PHY_DSIPHY_LN3_BIST_MISR_STAT1_ADDR A:0x1ac85fc
y.create.l HWIO_MDSS_DSI_0_PHY_DSIPHY_LNCK_CFG0_ADDR A:0x1ac8600
y.create.l HWIO_MDSS_DSI_0_PHY_DSIPHY_LNCK_CFG1_ADDR A:0x1ac8604
y.create.l HWIO_MDSS_DSI_0_PHY_DSIPHY_LNCK_CFG2_ADDR A:0x1ac8608
y.create.l HWIO_MDSS_DSI_0_PHY_DSIPHY_LNCK_CFG3_ADDR A:0x1ac860c
y.create.l HWIO_MDSS_DSI_0_PHY_DSIPHY_LNCK_CFG4_ADDR A:0x1ac8610
y.create.l HWIO_MDSS_DSI_0_PHY_DSIPHY_LNCK_TEST_DATAPATH_ADDR A:0x1ac8614
y.create.l HWIO_MDSS_DSI_0_PHY_DSIPHY_LNCK_DEBUG_SEL_ADDR A:0x1ac8618
y.create.l HWIO_MDSS_DSI_0_PHY_DSIPHY_LNCK_TEST_STR0_ADDR A:0x1ac861c
y.create.l HWIO_MDSS_DSI_0_PHY_DSIPHY_LNCK_TEST_STR1_ADDR A:0x1ac8620
y.create.l HWIO_MDSS_DSI_0_PHY_DSIPHY_LNCK_BIST_CTL0_ADDR A:0x1ac8624
y.create.l HWIO_MDSS_DSI_0_PHY_DSIPHY_LNCK_BIST_CTL1_ADDR A:0x1ac8628
y.create.l HWIO_MDSS_DSI_0_PHY_DSIPHY_LNCK_BIST_RXCHK_STATUS_ADDR A:0x1ac862c
y.create.l HWIO_MDSS_DSI_0_PHY_DSIPHY_LNCK_HSTX_STR_STATUS_ADDR A:0x1ac8630
y.create.l HWIO_MDSS_DSI_0_PHY_RSVD_1_PHY_LNCK_ADDR A:0x1ac8634
y.create.l HWIO_MDSS_DSI_0_PHY_DSIPHY_LNCK_BIST_MISR_STAT0_ADDR A:0x1ac8638
y.create.l HWIO_MDSS_DSI_0_PHY_DSIPHY_LNCK_BIST_MISR_STAT1_ADDR A:0x1ac863c
y.create.l HWIO_MDSS_DSI_0_PHY_DSIPHY_TIMING_CTRL_0_ADDR A:0x1ac8640
y.create.l HWIO_MDSS_DSI_0_PHY_DSIPHY_TIMING_CTRL_1_ADDR A:0x1ac8644
y.create.l HWIO_MDSS_DSI_0_PHY_DSIPHY_TIMING_CTRL_2_ADDR A:0x1ac8648
y.create.l HWIO_MDSS_DSI_0_PHY_DSIPHY_TIMING_CTRL_3_ADDR A:0x1ac864c
y.create.l HWIO_MDSS_DSI_0_PHY_DSIPHY_TIMING_CTRL_4_ADDR A:0x1ac8650
y.create.l HWIO_MDSS_DSI_0_PHY_DSIPHY_TIMING_CTRL_5_ADDR A:0x1ac8654
y.create.l HWIO_MDSS_DSI_0_PHY_DSIPHY_TIMING_CTRL_6_ADDR A:0x1ac8658
y.create.l HWIO_MDSS_DSI_0_PHY_DSIPHY_TIMING_CTRL_7_ADDR A:0x1ac865c
y.create.l HWIO_MDSS_DSI_0_PHY_DSIPHY_TIMING_CTRL_8_ADDR A:0x1ac8660
y.create.l HWIO_MDSS_DSI_0_PHY_DSIPHY_TIMING_CTRL_9_ADDR A:0x1ac8664
y.create.l HWIO_MDSS_DSI_0_PHY_DSIPHY_TIMING_CTRL_10_ADDR A:0x1ac8668
y.create.l HWIO_MDSS_DSI_0_PHY_DSIPHY_TIMING_CTRL_11_ADDR A:0x1ac866c
y.create.l HWIO_MDSS_DSI_0_PHY_DSIPHY_CTRL_0_ADDR A:0x1ac8670
y.create.l HWIO_MDSS_DSI_0_PHY_DSIPHY_CTRL_1_ADDR A:0x1ac8674
y.create.l HWIO_MDSS_DSI_0_PHY_DSIPHY_CTRL_2_ADDR A:0x1ac8678
y.create.l HWIO_MDSS_DSI_0_PHY_DSIPHY_CTRL_3_ADDR A:0x1ac867c
y.create.l HWIO_MDSS_DSI_0_PHY_DSIPHY_CTRL_4_ADDR A:0x1ac8680
y.create.l HWIO_MDSS_DSI_0_PHY_DSIPHY_STRENGTH_CTRL_0_ADDR A:0x1ac8684
y.create.l HWIO_MDSS_DSI_0_PHY_DSIPHY_STRENGTH_CTRL_1_ADDR A:0x1ac8688
y.create.l HWIO_MDSS_DSI_0_PHY_DSIPHY_CAL_HW_TRIGGER_ADDR A:0x1ac868c
y.create.l HWIO_MDSS_DSI_0_PHY_DSIPHY_CAL_SW_CFG0_ADDR A:0x1ac8690
y.create.l HWIO_MDSS_DSI_0_PHY_DSIPHY_CAL_SW_CFG1_ADDR A:0x1ac8694
y.create.l HWIO_MDSS_DSI_0_PHY_DSIPHY_CAL_SW_CFG2_ADDR A:0x1ac8698
y.create.l HWIO_MDSS_DSI_0_PHY_DSIPHY_CAL_HW_CFG0_ADDR A:0x1ac869c
y.create.l HWIO_MDSS_DSI_0_PHY_DSIPHY_CAL_HW_CFG1_ADDR A:0x1ac86a0
y.create.l HWIO_MDSS_DSI_0_PHY_DSIPHY_CAL_HW_CFG2_ADDR A:0x1ac86a4
y.create.l HWIO_MDSS_DSI_0_PHY_DSIPHY_CAL_HW_CFG3_ADDR A:0x1ac86a8
y.create.l HWIO_MDSS_DSI_0_PHY_DSIPHY_CAL_HW_CFG4_ADDR A:0x1ac86ac
y.create.l HWIO_MDSS_DSI_0_PHY_DSIPHY_CAL_TEST_EFUSE_ADDR A:0x1ac86b0
y.create.l HWIO_MDSS_DSI_0_PHY_DSIPHY_BIST_CTRL0_ADDR A:0x1ac86b4
y.create.l HWIO_MDSS_DSI_0_PHY_DSIPHY_BIST_CTRL1_ADDR A:0x1ac86b8
y.create.l HWIO_MDSS_DSI_0_PHY_DSIPHY_BIST_CTRL2_ADDR A:0x1ac86bc
y.create.l HWIO_MDSS_DSI_0_PHY_DSIPHY_BIST_CTRL3_ADDR A:0x1ac86c0
y.create.l HWIO_MDSS_DSI_0_PHY_DSIPHY_BIST_CTRL4_ADDR A:0x1ac86c4
y.create.l HWIO_MDSS_DSI_0_PHY_DSIPHY_BIST_CTRL5_ADDR A:0x1ac86c8
y.create.l HWIO_MDSS_DSI_0_PHY_RSVD_1_PHY_DIGTOP_ADDR A:0x1ac86cc
y.create.l HWIO_MDSS_DSI_0_PHY_DSIPHY_GLBL_MISR_CTRL_ADDR A:0x1ac86d0
y.create.l HWIO_MDSS_DSI_0_PHY_DSIPHY_GLBL_TEST_CTRL_ADDR A:0x1ac86d4
y.create.l HWIO_MDSS_DSI_0_PHY_DSIPHY_GLBL_DIGTOP_DEBUG_SEL_ADDR A:0x1ac86d8
y.create.l HWIO_MDSS_DSI_0_PHY_DSIPHY_LDO_CNTRL_ADDR A:0x1ac86dc
y.create.l HWIO_MDSS_DSI_0_PHY_DSIPHY_REGULATOR_CAL_STATUS0_ADDR A:0x1ac86e0
y.create.l HWIO_MDSS_DSI_0_PHY_DSIPHY_REGULATOR_CAL_STATUS1_ADDR A:0x1ac86e4
y.create.l HWIO_MDSS_DSI_0_PHY_DSIPHY_GLBL_STATUS_DCC_SEL_P_ADDR A:0x1ac86e8
y.create.l HWIO_MDSS_DSI_0_PHY_DSIPHY_GLBL_STATUS_DCC_SEL_N_ADDR A:0x1ac86ec
y.create.l HWIO_MDSS_DSI_0_PHY_DSIPHY_GLBL_STATUS_DEBUG_BUS0_ADDR A:0x1ac86f0
y.create.l HWIO_MDSS_DSI_0_PHY_DSIPHY_GLBL_STATUS_DEBUG_BUS1_ADDR A:0x1ac86f4
y.create.l HWIO_MDSS_DSI_0_PHY_DSIPHY_GLBL_STATUS_DEBUG_BUS2_ADDR A:0x1ac86f8
y.create.l HWIO_MDSS_DSI_0_PHY_DSIPHY_GLBL_STATUS_DEBUG_BUS3_ADDR A:0x1ac86fc
y.create.l HWIO_MDSS_DSI_0_PHY_DSIPHY_REVISION_ID0_ADDR A:0x1ac8700
y.create.l HWIO_MDSS_DSI_0_PHY_DSIPHY_REVISION_ID1_ADDR A:0x1ac8704
y.create.l HWIO_MDSS_DSI_0_PHY_DSIPHY_REVISION_ID2_ADDR A:0x1ac8708
y.create.l HWIO_MDSS_DSI_0_PHY_DSIPHY_REVISION_ID3_ADDR A:0x1ac870c
y.create.l HWIO_MDSS_DSI_0_PHY_REG_DSIPHY_REGULATOR_CTRL_0_ADDR A:0x1ac8780
y.create.l HWIO_MDSS_DSI_0_PHY_REG_DSIPHY_REGULATOR_CTRL_1_ADDR A:0x1ac8784
y.create.l HWIO_MDSS_DSI_0_PHY_REG_DSIPHY_REGULATOR_CTRL_2_ADDR A:0x1ac8788
y.create.l HWIO_MDSS_DSI_0_PHY_REG_DSIPHY_REGULATOR_CTRL_3_ADDR A:0x1ac878c
y.create.l HWIO_MDSS_DSI_0_PHY_REG_DSIPHY_REGULATOR_CTRL_4_ADDR A:0x1ac8790
y.create.l HWIO_MDSS_DSI_0_PHY_REG_DSIPHY_REGULATOR_CTRL_5_ADDR A:0x1ac8794
y.create.l HWIO_MDSS_DSI_0_PHY_REG_DSIPHY_REGULATOR_CAL_PWR_CFG_ADDR A:0x1ac8798
y.create.l HWIO_MDSS_DSI_0_PHY_REG_DSIPHY_REGULATOR_CTRL_6_ADDR A:0x1ac879c
y.create.l HWIO_MDSS_DSI_0_PHY_REG_DSIPHY_REGULATOR_RSVD_1_ADDR A:0x1ac87a0
y.create.l HWIO_MDSS_DSI_0_PHY_REG_DSIPHY_REG_CAL_DBG_SEL_ADDR A:0x1ac87a4
y.create.l HWIO_MDSS_DSI_0_PHY_REG_DSIPHY_REG_DBG_STAT0_ADDR A:0x1ac87a8
y.create.l HWIO_MDSS_DSI_0_PHY_REG_DSIPHY_REG_DBG_STAT1_ADDR A:0x1ac87ac
y.create.l HWIO_MDSS_VBIF_VERSION_ADDR A:0x1ab0000
y.create.l HWIO_MDSS_VBIF_CLKON_ADDR A:0x1ab0004
y.create.l HWIO_MDSS_VBIF_CLK_FORCE_CTRL0_ADDR A:0x1ab0008
y.create.l HWIO_MDSS_VBIF_CLK_FORCE_CTRL1_ADDR A:0x1ab000c
y.create.l HWIO_MDSS_VBIF_QOS_OVERRIDE_EN_ADDR A:0x1ab0010
y.create.l HWIO_MDSS_VBIF_PRILVL_ACT_PROP_EN_ADDR A:0x1ab0014
y.create.l HWIO_MDSS_VBIF_QOS_OVERRIDE_REQPRI_ADDR A:0x1ab0018
y.create.l HWIO_MDSS_VBIF_QOS_OVERRIDE_PRILVL_ADDR A:0x1ab001c
y.create.l HWIO_MDSS_VBIF_QOS_REMAP_00_ADDR A:0x1ab0020
y.create.l HWIO_MDSS_VBIF_QOS_REMAP_01_ADDR A:0x1ab0024
y.create.l HWIO_MDSS_VBIF_QOS_REMAP_10_ADDR A:0x1ab0028
y.create.l HWIO_MDSS_VBIF_QOS_REMAP_11_ADDR A:0x1ab002c
y.create.l HWIO_MDSS_VBIF_IN_RD_LIM_CONF0_ADDR A:0x1ab00b0
y.create.l HWIO_MDSS_VBIF_IN_WR_LIM_CONF0_ADDR A:0x1ab00c0
y.create.l HWIO_MDSS_VBIF_OUT_RD_LIM_CONF0_ADDR A:0x1ab00d0
y.create.l HWIO_MDSS_VBIF_OUT_WR_LIM_CONF0_ADDR A:0x1ab00d4
y.create.l HWIO_MDSS_VBIF_DDR_OUT_MAX_BURST_ADDR A:0x1ab00d8
y.create.l HWIO_MDSS_VBIF_ISO_SYNC_ADDR A:0x1ab00e0
y.create.l HWIO_MDSS_VBIF_ARB_CTL_ADDR A:0x1ab00f0
y.create.l HWIO_MDSS_VBIF_DDR_ARB_CONF0_ADDR A:0x1ab00f4
y.create.l HWIO_MDSS_VBIF_FIXED_ARB_CONF0_ADDR A:0x1ab0100
y.create.l HWIO_MDSS_VBIF_ROUND_ROBIN_QOS_ARB_ADDR A:0x1ab0124
y.create.l HWIO_MDSS_VBIF_OUT_AXI_AMEMTYPE_CONF0_ADDR A:0x1ab0160
y.create.l HWIO_MDSS_VBIF_OUT_AXI_AINST_OVERRIDE_EN_ADDR A:0x1ab0168
y.create.l HWIO_MDSS_VBIF_OUT_AXI_AINST_ADDR A:0x1ab016c
y.create.l HWIO_MDSS_VBIF_OUT_AXI_ASHARED_ADDR A:0x1ab0170
y.create.l HWIO_MDSS_VBIF_OUT_AXI_AINNERSHARED_ADDR A:0x1ab0174
y.create.l HWIO_MDSS_VBIF_OUT_AXI_AOOO_EN_ADDR A:0x1ab0178
y.create.l HWIO_MDSS_VBIF_OUT_AXI_AOOO_ADDR A:0x1ab017c
y.create.l HWIO_MDSS_VBIF_OUT_AXI_ANOALLOCATE_ADDR A:0x1ab0180
y.create.l HWIO_MDSS_VBIF_WD_TIMEOUT_ADDR A:0x1ab0184
y.create.l HWIO_MDSS_VBIF_PND_ERR_ADDR A:0x1ab0190
y.create.l HWIO_MDSS_VBIF_SRC_ERR_ADDR A:0x1ab0194
y.create.l HWIO_MDSS_VBIF_ERR_MASK_ADDR A:0x1ab0198
y.create.l HWIO_MDSS_VBIF_ERR_CLR_ADDR A:0x1ab019c
y.create.l HWIO_MDSS_VBIF_ERR_INFO_ADDR A:0x1ab01a0
y.create.l HWIO_MDSS_VBIF_AXI_TEST_CTL_ADDR A:0x1ab01b0
y.create.l HWIO_MDSS_VBIF_AXI_TEST_OUT_ADDR A:0x1ab01b4
y.create.l HWIO_MDSS_VBIF_XIN_HALT_CTRL0_ADDR A:0x1ab0200
y.create.l HWIO_MDSS_VBIF_XIN_HALT_CTRL1_ADDR A:0x1ab0204
y.create.l HWIO_MDSS_VBIF_AXI_HALT_CTRL0_ADDR A:0x1ab0208
y.create.l HWIO_MDSS_VBIF_AXI_HALT_CTRL1_ADDR A:0x1ab020c
y.create.l HWIO_MDSS_VBIF_TEST_BUS_OUT_CTRL_ADDR A:0x1ab0210
y.create.l HWIO_MDSS_VBIF_TEST_BUS1_CTRL0_ADDR A:0x1ab0214
y.create.l HWIO_MDSS_VBIF_TEST_BUS1_CTRL1_ADDR A:0x1ab0218
y.create.l HWIO_MDSS_VBIF_TEST_BUS2_CTRL0_ADDR A:0x1ab021c
y.create.l HWIO_MDSS_VBIF_TEST_BUS2_CTRL1_ADDR A:0x1ab0220
y.create.l HWIO_MDSS_VBIF_TEST_BUS_AHB_CTRL_ADDR A:0x1ab022c
y.create.l HWIO_MDSS_VBIF_TEST_BUS_OUT_ADDR A:0x1ab0230
y.create.l HWIO_MDSS_VBIF_ATB_CONF0_ADDR A:0x1ab0240
y.create.l HWIO_MDSS_VBIF_ATB_CONF1_ADDR A:0x1ab0244
y.create.l HWIO_MDSS_VBIF_ATB_CONF2_ADDR A:0x1ab0248
y.create.l HWIO_MDSS_VBIF_ATB_CONF3_ADDR A:0x1ab024c
y.create.l HWIO_MDSS_VBIF_ATB_TEST_VALUE_ADDR A:0x1ab0250
y.create.l HWIO_MDSS_VBIF_STM_CONF_ADDR A:0x1ab0260
y.create.l HWIO_MDSS_VBIF_WR_BUF_FOR_AP_ADDR A:0x1ab0270
y.create.l HWIO_MDSS_VBIF_PERF_CNT_EN0_ADDR A:0x1ab0300
y.create.l HWIO_MDSS_VBIF_PERF_CNT_EN1_ADDR A:0x1ab0304
y.create.l HWIO_MDSS_VBIF_PERF_CNT_CLR0_ADDR A:0x1ab0320
y.create.l HWIO_MDSS_VBIF_PERF_CNT_CLR1_ADDR A:0x1ab0324
y.create.l HWIO_MDSS_VBIF_PERF_CNT_SEL0_ADDR A:0x1ab0340
y.create.l HWIO_MDSS_VBIF_PERF_CNT_SEL1_ADDR A:0x1ab0344
y.create.l HWIO_MDSS_VBIF_PERF_CNT_L0_ADDR A:0x1ab0360
y.create.l HWIO_MDSS_VBIF_PERF_CNT_L1_ADDR A:0x1ab0364
y.create.l HWIO_MDSS_VBIF_PERF_CNT_H0_ADDR A:0x1ab0380
y.create.l HWIO_MDSS_VBIF_PERF_CNT_H1_ADDR A:0x1ab0384
y.create.l HWIO_MDSS_VBIF_PERF_PWR_CNT_EN0_ADDR A:0x1ab0400
y.create.l HWIO_MDSS_VBIF_PERF_PWR_CNT_EN1_ADDR A:0x1ab0404
y.create.l HWIO_MDSS_VBIF_PERF_PWR_CNT_EN2_ADDR A:0x1ab0408
y.create.l HWIO_MDSS_VBIF_PERF_PWR_CNT_CLR0_ADDR A:0x1ab0420
y.create.l HWIO_MDSS_VBIF_PERF_PWR_CNT_CLR1_ADDR A:0x1ab0424
y.create.l HWIO_MDSS_VBIF_PERF_PWR_CNT_CLR2_ADDR A:0x1ab0428
y.create.l HWIO_MDSS_VBIF_PERF_PWR_CNT_L0_ADDR A:0x1ab0440
y.create.l HWIO_MDSS_VBIF_PERF_PWR_CNT_L1_ADDR A:0x1ab0444
y.create.l HWIO_MDSS_VBIF_PERF_PWR_CNT_L2_ADDR A:0x1ab0448
y.create.l HWIO_MDSS_VBIF_PERF_PWR_CNT_H0_ADDR A:0x1ab0460
y.create.l HWIO_MDSS_VBIF_PERF_PWR_CNT_H1_ADDR A:0x1ab0464
y.create.l HWIO_MDSS_VBIF_PERF_PWR_CNT_H2_ADDR A:0x1ab0468
y.create.l HWIO_MDSS_VBIF_MISR_CFG_A0_ADDR A:0x1ab0480
y.create.l HWIO_MDSS_VBIF_MISR_COUNTER_ADDR A:0x1ab0490
y.create.l HWIO_MDSS_VBIF_MISR_CLR_A0_ADDR A:0x1ab0494
y.create.l HWIO_MDSS_VBIF_MISR_A0_SIG0_ADDR A:0x1ab04a4
y.create.l HWIO_MDSS_VBIF_MISR_A0_SIG1_ADDR A:0x1ab04a8
y.create.l HWIO_MDSS_VBIF_MISR_A0_SIG2_ADDR A:0x1ab04ac
y.create.l HWIO_MDSS_VBIF_MISR_A0_SIG3_ADDR A:0x1ab04b0
y.create.l HWIO_MDSS_VBIF_ATB_EN_ADDR A:0x1ab1030
y.create.l HWIO_MDSS_VBIF_STM_EN_ADDR A:0x1ab1040
y.create.l HWIO_MDSS_VBIF_DDR_OUTPUT_RECOVERABLE_HALT_CTRL0_ADDR A:0x1ab2000
y.create.l HWIO_MDSS_VBIF_DDR_OUTPUT_RECOVERABLE_HALT_CTRL1_ADDR A:0x1ab2004
y.create.l HWIO_MPM2_MPM_PMIC_VDD_ON_CFG_1_ADDR A:0x4a0000
y.create.l HWIO_MPM2_MPM_PMIC_VDD_ON_CFG_2_ADDR A:0x4a0004
y.create.l HWIO_MPM2_MPM_PMIC_VDD_ON_CFG_3_ADDR A:0x4a0008
y.create.l HWIO_MPM2_MPM_PMIC_VDD_ON_CFG_4_ADDR A:0x4a000c
y.create.l HWIO_MPM2_MPM_PMIC_VDD_ON_CFG_5_ADDR A:0x4a0010
y.create.l HWIO_MPM2_MPM_PMIC_VDD_ON_CFG_6_ADDR A:0x4a0014
y.create.l HWIO_MPM2_MPM_PMIC_VDD_ON_CFG_7_ADDR A:0x4a0018
y.create.l HWIO_MPM2_MPM_PMIC_VDD_ON_CFG_8_ADDR A:0x4a001c
y.create.l HWIO_MPM2_MPM_PMIC_VDD_ON_CFG_9_ADDR A:0x4a0020
y.create.l HWIO_MPM2_MPM_PMIC_VDD_ON_CFG_10_ADDR A:0x4a0024
y.create.l HWIO_MPM2_MPM_PMIC_VDD_ON_CFG_11_ADDR A:0x4a0028
y.create.l HWIO_MPM2_MPM_PMIC_VDD_ON_CFG_12_ADDR A:0x4a002c
y.create.l HWIO_MPM2_MPM_PMIC_VDD_OFF_CFG_1_ADDR A:0x4a0030
y.create.l HWIO_MPM2_MPM_PMIC_VDD_OFF_CFG_2_ADDR A:0x4a0034
y.create.l HWIO_MPM2_MPM_PMIC_VDD_OFF_CFG_3_ADDR A:0x4a0038
y.create.l HWIO_MPM2_MPM_PMIC_VDD_OFF_CFG_4_ADDR A:0x4a003c
y.create.l HWIO_MPM2_MPM_PMIC_VDD_OFF_CFG_5_ADDR A:0x4a0040
y.create.l HWIO_MPM2_MPM_PMIC_VDD_OFF_CFG_6_ADDR A:0x4a0044
y.create.l HWIO_MPM2_MPM_PMIC_VDD_OFF_CFG_7_ADDR A:0x4a0048
y.create.l HWIO_MPM2_MPM_PMIC_VDD_OFF_CFG_8_ADDR A:0x4a004c
y.create.l HWIO_MPM2_MPM_PMIC_VDD_OFF_CFG_9_ADDR A:0x4a0050
y.create.l HWIO_MPM2_MPM_PMIC_VDD_OFF_CFG_10_ADDR A:0x4a0054
y.create.l HWIO_MPM2_MPM_PMIC_VDD_OFF_CFG_11_ADDR A:0x4a0058
y.create.l HWIO_MPM2_MPM_PMIC_VDD_OFF_CFG_12_ADDR A:0x4a005c
y.create.l HWIO_MPM2_MPM_SPMI_CMD_CFG_ADDR A:0x4a0060
y.create.l HWIO_MPM2_MPM_SPMI_CDIV_CNTRL_ADDR A:0x4a0064
y.create.l HWIO_MPM2_MPM_CXO_CTRL_ADDR A:0x4a0068
y.create.l HWIO_MPM2_MPM_PXO_OSC_CTRL_ADDR A:0x4a006c
y.create.l HWIO_MPM2_MPM_LOW_POWER_CFG_ADDR A:0x4a0070
y.create.l HWIO_MPM2_MPM_LOW_POWER_STATUS_ADDR A:0x4a0074
y.create.l HWIO_MPM2_MPM_CXO_POWER_RAMPUP_TIME_ADDR A:0x4a0078
y.create.l HWIO_MPM2_MPM_PXO_WARMUP_TIME_ADDR A:0x4a007c
y.create.l HWIO_MPM2_MPM_HARDWARE_RESTORED_ADDR A:0x4a0080
y.create.l HWIO_MPM2_MPM_INT_CLEAR_1_ADDR A:0x4a0084
y.create.l HWIO_MPM2_MPM_INT_CLEAR_2_ADDR A:0x4a0088
y.create.l HWIO_MPM2_MPM_INT_EN_1_ADDR A:0x4a008c
y.create.l HWIO_MPM2_MPM_INT_EN_2_ADDR A:0x4a0090
y.create.l HWIO_MPM2_MPM_INT_POLARITY_1_ADDR A:0x4a0094
y.create.l HWIO_MPM2_MPM_INT_POLARITY_2_ADDR A:0x4a0098
y.create.l HWIO_MPM2_MPM_DETECT_CTL_1_ADDR A:0x4a009c
y.create.l HWIO_MPM2_MPM_DETECT_CTL_2_ADDR A:0x4a00a0
y.create.l HWIO_MPM2_MPM_DETECT_CTL_3_ADDR A:0x4a00a4
y.create.l HWIO_MPM2_MPM_DETECT_CTL_4_ADDR A:0x4a00a8
y.create.l HWIO_MPM2_MPM_INT_STATUS_1_ADDR A:0x4a00ac
y.create.l HWIO_MPM2_MPM_INT_STATUS_2_ADDR A:0x4a00b0
y.create.l HWIO_MPM2_MPM_INT_WKUP_CLK_SEL_1_ADDR A:0x4a00b4
y.create.l HWIO_MPM2_MPM_INT_WKUP_CLK_SEL_2_ADDR A:0x4a00b8
y.create.l HWIO_MPM2_MPM_DEBUG_BUS_EN_ADDR A:0x4a00bc
y.create.l HWIO_MPM2_MPM_PEN_DEBOUNCE_CTL_ADDR A:0x4a00c0
y.create.l HWIO_MPM2_MPM_WARM_BOOT_CFG_ADDR A:0x4a00c4
y.create.l HWIO_MPM2_MPM_REG0_FILE_ADDR A:0x4a00c8
y.create.l HWIO_MPM2_MPM_REG1_FILE_ADDR A:0x4a00cc
y.create.l HWIO_MPM2_MPM_REG2_FILE_ADDR A:0x4a00d0
y.create.l HWIO_MPM2_MPM_REG3_FILE_ADDR A:0x4a00d4
y.create.l HWIO_MPM2_MPM_REG4_FILE_ADDR A:0x4a00d8
y.create.l HWIO_MPM2_MPM_REG5_FILE_ADDR A:0x4a00dc
y.create.l HWIO_MPM2_MPM_REG6_FILE_ADDR A:0x4a00e0
y.create.l HWIO_MPM2_MPM_REG7_FILE_ADDR A:0x4a00e4
y.create.l HWIO_MPM2_MPM_REG8_FILE_ADDR A:0x4a00e8
y.create.l HWIO_MPM2_MPM_CNTR_CLK_CONTROL_ADDR A:0x4a00ec
y.create.l HWIO_MPM2_MPM_CNTR_FRAC_ADDR A:0x4a00f0
y.create.l HWIO_MPM2_MPM_CNTR_INCR_DATA_ADDR A:0x4a00f4
y.create.l HWIO_MPM2_MPM_HW_ID_ADDR A:0x4a00f8
y.create.l HWIO_MPM2_MPM_CONTROL_CNTCR_ADDR A:0x4a1000
y.create.l HWIO_MPM2_MPM_CONTROL_CNTSR_ADDR A:0x4a1004
y.create.l HWIO_MPM2_MPM_CONTROL_CNTCV_LO_ADDR A:0x4a1008
y.create.l HWIO_MPM2_MPM_CONTROL_CNTCV_HI_ADDR A:0x4a100c
y.create.l HWIO_MPM2_MPM_CONTROL_CNTFID0_ADDR A:0x4a1020
y.create.l HWIO_MPM2_MPM_CONTROL_ID_ADDR A:0x4a1fd0
y.create.l HWIO_MPM2_MPM_READ_CNTCV_LO_ADDR A:0x4a2000
y.create.l HWIO_MPM2_MPM_READ_CNTCV_HI_ADDR A:0x4a2004
y.create.l HWIO_MPM2_MPM_READ_ID_ADDR A:0x4a2fd0
y.create.l HWIO_MPM2_MPM_SLEEP_TIMETICK_COUNT_VAL_ADDR A:0x4a3000
y.create.l HWIO_MPM2_QTMR_AC_CNTFRQ_ADDR A:0x4a4000
y.create.l HWIO_MPM2_QTMR_AC_CNTSR_ADDR A:0x4a4004
y.create.l HWIO_MPM2_QTMR_AC_CNTTID_ADDR A:0x4a4008
y.create.l HWIO_MPM2_QTMR_AC_CNTACR_0_ADDR A:0x4a4040
y.create.l HWIO_MPM2_QTMR_AC_CNTVOFF_LO_0_ADDR A:0x4a4080
y.create.l HWIO_MPM2_QTMR_AC_CNTVOFF_HI_0_ADDR A:0x4a4084
y.create.l HWIO_MPM2_QTMR_AC_CFG_ADDR A:0x4a4fc0
y.create.l HWIO_MPM2_QTMR_AC_VERSION_ADDR A:0x4a4fd0
y.create.l HWIO_MPM2_QTMR_V1_CNTPCT_LO_ADDR A:0x4a5000
y.create.l HWIO_MPM2_QTMR_V1_CNTPCT_HI_ADDR A:0x4a5004
y.create.l HWIO_MPM2_QTMR_V1_CNTVCT_LO_ADDR A:0x4a5008
y.create.l HWIO_MPM2_QTMR_V1_CNTVCT_HI_ADDR A:0x4a500c
y.create.l HWIO_MPM2_QTMR_V1_CNTFRQ_ADDR A:0x4a5010
y.create.l HWIO_MPM2_QTMR_V1_CNTPL0ACR_ADDR A:0x4a5014
y.create.l HWIO_MPM2_QTMR_V1_CNTVOFF_LO_ADDR A:0x4a5018
y.create.l HWIO_MPM2_QTMR_V1_CNTVOFF_HI_ADDR A:0x4a501c
y.create.l HWIO_MPM2_QTMR_V1_CNTP_CVAL_LO_ADDR A:0x4a5020
y.create.l HWIO_MPM2_QTMR_V1_CNTP_CVAL_HI_ADDR A:0x4a5024
y.create.l HWIO_MPM2_QTMR_V1_CNTP_TVAL_ADDR A:0x4a5028
y.create.l HWIO_MPM2_QTMR_V1_CNTP_CTL_ADDR A:0x4a502c
y.create.l HWIO_MPM2_QTMR_V1_CNTV_CVAL_LO_ADDR A:0x4a5030
y.create.l HWIO_MPM2_QTMR_V1_CNTV_CVAL_HI_ADDR A:0x4a5034
y.create.l HWIO_MPM2_QTMR_V1_CNTV_TVAL_ADDR A:0x4a5038
y.create.l HWIO_MPM2_QTMR_V1_CNTV_CTL_ADDR A:0x4a503c
y.create.l HWIO_MPM2_QTMR_V1_VERSION_ADDR A:0x4a5fd0
y.create.l HWIO_MPM2_MPM_TSYNC_CTL_ADDR A:0x4a6000
y.create.l HWIO_MPM2_MPM_TSYNC_CMD_ADDR A:0x4a6004
y.create.l HWIO_MPM2_MPM_TSYNC_START_ADDR A:0x4a6008
y.create.l HWIO_MPM2_MPM_TSYNC_START_PHASE_ADDR A:0x4a600c
y.create.l HWIO_MPM2_MPM_TSYNC_PERIOD_ADDR A:0x4a6010
y.create.l HWIO_MPM2_MPM_TSYNC_PERIOD_PHASE_ADDR A:0x4a6014
y.create.l HWIO_MPM2_MPM_TSYNC_STATUS_TIME_ADDR A:0x4a6018
y.create.l HWIO_MPM2_MPM_TSYNC_STATUS_PHASE_ADDR A:0x4a601c
y.create.l HWIO_MPM2_MPM_GRFC_CXO_EN_ADDR A:0x4a6020
y.create.l HWIO_MPM2_XPU_SCR_ADDR A:0x4a7000
y.create.l HWIO_MPM2_XPU_SWDR_ADDR A:0x4a7004
y.create.l HWIO_MPM2_XPU_SEAR0_ADDR A:0x4a7040
y.create.l HWIO_MPM2_XPU_SESR_ADDR A:0x4a7048
y.create.l HWIO_MPM2_XPU_SESRRESTORE_ADDR A:0x4a704c
y.create.l HWIO_MPM2_XPU_SESYNR0_ADDR A:0x4a7050
y.create.l HWIO_MPM2_XPU_SESYNR1_ADDR A:0x4a7054
y.create.l HWIO_MPM2_XPU_SESYNR2_ADDR A:0x4a7058
y.create.l HWIO_MPM2_XPU_MCR_ADDR A:0x4a7100
y.create.l HWIO_MPM2_XPU_MEAR0_ADDR A:0x4a7140
y.create.l HWIO_MPM2_XPU_MESR_ADDR A:0x4a7148
y.create.l HWIO_MPM2_XPU_MESRRESTORE_ADDR A:0x4a714c
y.create.l HWIO_MPM2_XPU_MESYNR0_ADDR A:0x4a7150
y.create.l HWIO_MPM2_XPU_MESYNR1_ADDR A:0x4a7154
y.create.l HWIO_MPM2_XPU_MESYNR2_ADDR A:0x4a7158
y.create.l HWIO_MPM2_XPU_CR_ADDR A:0x4a7080
y.create.l HWIO_MPM2_XPU_RPU_ACR0_ADDR A:0x4a70a0
y.create.l HWIO_MPM2_XPU_EAR0_ADDR A:0x4a70c0
y.create.l HWIO_MPM2_XPU_ESR_ADDR A:0x4a70c8
y.create.l HWIO_MPM2_XPU_ESRRESTORE_ADDR A:0x4a70cc
y.create.l HWIO_MPM2_XPU_ESYNR0_ADDR A:0x4a70d0
y.create.l HWIO_MPM2_XPU_ESYNR1_ADDR A:0x4a70d4
y.create.l HWIO_MPM2_XPU_ESYNR2_ADDR A:0x4a70d8
y.create.l HWIO_MPM2_XPU_IDR0_ADDR A:0x4a7074
y.create.l HWIO_MPM2_XPU_IDR1_ADDR A:0x4a7078
y.create.l HWIO_MPM2_XPU_REV_ADDR A:0x4a707c
y.create.l HWIO_MPM2_XPU_RG0_RACR0_ADDR A:0x4a7200
y.create.l HWIO_MPM2_XPU_RG1_RACR0_ADDR A:0x4a7280
y.create.l HWIO_MPM2_XPU_RG2_RACR0_ADDR A:0x4a7300
y.create.l HWIO_MPM2_XPU_RG3_RACR0_ADDR A:0x4a7380
y.create.l HWIO_MPM2_XPU_RG4_RACR0_ADDR A:0x4a7400
y.create.l HWIO_MPM2_XPU_RG5_RACR0_ADDR A:0x4a7480
y.create.l HWIO_MPM2_XPU_RG6_RACR0_ADDR A:0x4a7500
y.create.l HWIO_MPM2_XPU_RG7_RACR0_ADDR A:0x4a7580
y.create.l HWIO_MPM2_XPU_RG8_RACR0_ADDR A:0x4a7600
y.create.l HWIO_MPM2_XPU_RG9_RACR0_ADDR A:0x4a7680
y.create.l HWIO_MPM2_XPU_RG0_SCR_ADDR A:0x4a7250
y.create.l HWIO_MPM2_XPU_RG1_SCR_ADDR A:0x4a72d0
y.create.l HWIO_MPM2_XPU_RG2_SCR_ADDR A:0x4a7350
y.create.l HWIO_MPM2_XPU_RG3_SCR_ADDR A:0x4a73d0
y.create.l HWIO_MPM2_XPU_RG4_SCR_ADDR A:0x4a7450
y.create.l HWIO_MPM2_XPU_RG5_SCR_ADDR A:0x4a74d0
y.create.l HWIO_MPM2_XPU_RG6_SCR_ADDR A:0x4a7550
y.create.l HWIO_MPM2_XPU_RG7_SCR_ADDR A:0x4a75d0
y.create.l HWIO_MPM2_XPU_RG8_SCR_ADDR A:0x4a7650
y.create.l HWIO_MPM2_XPU_RG9_SCR_ADDR A:0x4a76d0
y.create.l HWIO_MPM2_XPU_RG0_MCR_ADDR A:0x4a7254
y.create.l HWIO_MPM2_XPU_RG1_MCR_ADDR A:0x4a72d4
y.create.l HWIO_MPM2_XPU_RG2_MCR_ADDR A:0x4a7354
y.create.l HWIO_MPM2_XPU_RG3_MCR_ADDR A:0x4a73d4
y.create.l HWIO_MPM2_XPU_RG4_MCR_ADDR A:0x4a7454
y.create.l HWIO_MPM2_XPU_RG5_MCR_ADDR A:0x4a74d4
y.create.l HWIO_MPM2_XPU_RG6_MCR_ADDR A:0x4a7554
y.create.l HWIO_MPM2_XPU_RG7_MCR_ADDR A:0x4a75d4
y.create.l HWIO_MPM2_XPU_RG8_MCR_ADDR A:0x4a7654
y.create.l HWIO_MPM2_XPU_RG9_MCR_ADDR A:0x4a76d4
y.create.l HWIO_MPM2_TSENS_CTRL_ADDR A:0x4a8000
y.create.l HWIO_MPM2_TSENS_TEST_CTRL_ADDR A:0x4a8004
y.create.l HWIO_MPM2_TSENS_S0_MIN_MAX_STATUS_CTRL_ADDR A:0x4a8008
y.create.l HWIO_MPM2_TSENS_S1_MIN_MAX_STATUS_CTRL_ADDR A:0x4a800c
y.create.l HWIO_MPM2_TSENS_S2_MIN_MAX_STATUS_CTRL_ADDR A:0x4a8010
y.create.l HWIO_MPM2_TSENS_S3_MIN_MAX_STATUS_CTRL_ADDR A:0x4a8014
y.create.l HWIO_MPM2_TSENS_S4_MIN_MAX_STATUS_CTRL_ADDR A:0x4a8018
y.create.l HWIO_MPM2_TSENS_S5_MIN_MAX_STATUS_CTRL_ADDR A:0x4a801c
y.create.l HWIO_MPM2_TSENS_S6_MIN_MAX_STATUS_CTRL_ADDR A:0x4a8020
y.create.l HWIO_MPM2_TSENS_S7_MIN_MAX_STATUS_CTRL_ADDR A:0x4a8024
y.create.l HWIO_MPM2_TSENS_S8_MIN_MAX_STATUS_CTRL_ADDR A:0x4a8028
y.create.l HWIO_MPM2_TSENS_S9_MIN_MAX_STATUS_CTRL_ADDR A:0x4a802c
y.create.l HWIO_MPM2_TSENS_GLOBAL_CONFIG_ADDR A:0x4a8034
y.create.l HWIO_MPM2_TSENS_S0_MAIN_CONFIG_ADDR A:0x4a8038
y.create.l HWIO_MPM2_TSENS_S1_REMOTE_CONFIG_ADDR A:0x4a8040
y.create.l HWIO_MPM2_TSENS_S2_REMOTE_CONFIG_ADDR A:0x4a8044
y.create.l HWIO_MPM2_TSENS_S3_REMOTE_CONFIG_ADDR A:0x4a8048
y.create.l HWIO_MPM2_TSENS_S4_REMOTE_CONFIG_ADDR A:0x4a804c
y.create.l HWIO_MPM2_TSENS_S5_REMOTE_CONFIG_ADDR A:0x4a8050
y.create.l HWIO_MPM2_TSENS_S6_REMOTE_CONFIG_ADDR A:0x4a8054
y.create.l HWIO_MPM2_TSENS_S7_REMOTE_CONFIG_ADDR A:0x4a8058
y.create.l HWIO_MPM2_TSENS_S8_REMOTE_CONFIG_ADDR A:0x4a805c
y.create.l HWIO_MPM2_TSENS_S9_REMOTE_CONFIG_ADDR A:0x4a8060
y.create.l HWIO_MPM2_TSENS_S10_REMOTE_CONFIG_ADDR A:0x4a8064
y.create.l HWIO_MPM2_TSENS_UPPER_LOWER_INTERRUPT_CTRL_ADDR A:0x4a9000
y.create.l HWIO_MPM2_TSENS_S0_UPPER_LOWER_STATUS_CTRL_ADDR A:0x4a9004
y.create.l HWIO_MPM2_TSENS_S1_UPPER_LOWER_STATUS_CTRL_ADDR A:0x4a9008
y.create.l HWIO_MPM2_TSENS_S2_UPPER_LOWER_STATUS_CTRL_ADDR A:0x4a900c
y.create.l HWIO_MPM2_TSENS_S3_UPPER_LOWER_STATUS_CTRL_ADDR A:0x4a9010
y.create.l HWIO_MPM2_TSENS_S4_UPPER_LOWER_STATUS_CTRL_ADDR A:0x4a9014
y.create.l HWIO_MPM2_TSENS_S5_UPPER_LOWER_STATUS_CTRL_ADDR A:0x4a9018
y.create.l HWIO_MPM2_TSENS_S6_UPPER_LOWER_STATUS_CTRL_ADDR A:0x4a901c
y.create.l HWIO_MPM2_TSENS_S7_UPPER_LOWER_STATUS_CTRL_ADDR A:0x4a9020
y.create.l HWIO_MPM2_TSENS_S8_UPPER_LOWER_STATUS_CTRL_ADDR A:0x4a9024
y.create.l HWIO_MPM2_TSENS_S9_UPPER_LOWER_STATUS_CTRL_ADDR A:0x4a9028
y.create.l HWIO_MPM2_TSENS_S0_STATUS_ADDR A:0x4a9030
y.create.l HWIO_MPM2_TSENS_S1_STATUS_ADDR A:0x4a9034
y.create.l HWIO_MPM2_TSENS_S2_STATUS_ADDR A:0x4a9038
y.create.l HWIO_MPM2_TSENS_S3_STATUS_ADDR A:0x4a903c
y.create.l HWIO_MPM2_TSENS_S4_STATUS_ADDR A:0x4a9040
y.create.l HWIO_MPM2_TSENS_S5_STATUS_ADDR A:0x4a9044
y.create.l HWIO_MPM2_TSENS_S6_STATUS_ADDR A:0x4a9048
y.create.l HWIO_MPM2_TSENS_S7_STATUS_ADDR A:0x4a904c
y.create.l HWIO_MPM2_TSENS_S8_STATUS_ADDR A:0x4a9050
y.create.l HWIO_MPM2_TSENS_S9_STATUS_ADDR A:0x4a9054
y.create.l HWIO_MPM2_TSENS_TRDY_ADDR A:0x4a905c
y.create.l HWIO_MPM2_WDOG_RESET_REG_ADDR A:0x4aa000
y.create.l HWIO_MPM2_WDOG_CTL_REG_ADDR A:0x4aa004
y.create.l HWIO_MPM2_WDOG_STATUS_REG_ADDR A:0x4aa008
y.create.l HWIO_MPM2_WDOG_BARK_VAL_REG_ADDR A:0x4aa00c
y.create.l HWIO_MPM2_WDOG_BITE_VAL_REG_ADDR A:0x4aa010
y.create.l HWIO_MPM2_MPM_PS_HOLD_ADDR A:0x4ab000
y.create.l HWIO_MPM2_MPM_DDR_PHY_FREEZEIO_EBI1_ADDR A:0x4ab004
y.create.l HWIO_MSS_XPU_SCR_ADDR A:0x4000000
y.create.l HWIO_MSS_XPU_SWDR_ADDR A:0x4000004
y.create.l HWIO_MSS_XPU_SEAR0_ADDR A:0x4000040
y.create.l HWIO_MSS_XPU_SESR_ADDR A:0x4000048
y.create.l HWIO_MSS_XPU_SESRRESTORE_ADDR A:0x400004c
y.create.l HWIO_MSS_XPU_SESYNR0_ADDR A:0x4000050
y.create.l HWIO_MSS_XPU_SESYNR1_ADDR A:0x4000054
y.create.l HWIO_MSS_XPU_SESYNR2_ADDR A:0x4000058
y.create.l HWIO_MSS_XPU_MCR_ADDR A:0x4000100
y.create.l HWIO_MSS_XPU_MEAR0_ADDR A:0x4000140
y.create.l HWIO_MSS_XPU_MESR_ADDR A:0x4000148
y.create.l HWIO_MSS_XPU_MESRRESTORE_ADDR A:0x400014c
y.create.l HWIO_MSS_XPU_MESYNR0_ADDR A:0x4000150
y.create.l HWIO_MSS_XPU_MESYNR1_ADDR A:0x4000154
y.create.l HWIO_MSS_XPU_MESYNR2_ADDR A:0x4000158
y.create.l HWIO_MSS_XPU_CR_ADDR A:0x4000080
y.create.l HWIO_MSS_XPU_RPU_ACR0_ADDR A:0x40000a0
y.create.l HWIO_MSS_XPU_EAR0_ADDR A:0x40000c0
y.create.l HWIO_MSS_XPU_ESR_ADDR A:0x40000c8
y.create.l HWIO_MSS_XPU_ESRRESTORE_ADDR A:0x40000cc
y.create.l HWIO_MSS_XPU_ESYNR0_ADDR A:0x40000d0
y.create.l HWIO_MSS_XPU_ESYNR1_ADDR A:0x40000d4
y.create.l HWIO_MSS_XPU_ESYNR2_ADDR A:0x40000d8
y.create.l HWIO_MSS_XPU_IDR0_ADDR A:0x4000074
y.create.l HWIO_MSS_XPU_IDR1_ADDR A:0x4000078
y.create.l HWIO_MSS_XPU_REV_ADDR A:0x400007c
y.create.l HWIO_MSS_XPU_RG0_RACR0_ADDR A:0x4000200
y.create.l HWIO_MSS_XPU_RG1_RACR0_ADDR A:0x4000280
y.create.l HWIO_MSS_XPU_RG2_RACR0_ADDR A:0x4000300
y.create.l HWIO_MSS_XPU_RG3_RACR0_ADDR A:0x4000380
y.create.l HWIO_MSS_XPU_RG4_RACR0_ADDR A:0x4000400
y.create.l HWIO_MSS_XPU_RG0_SCR_ADDR A:0x4000250
y.create.l HWIO_MSS_XPU_RG1_SCR_ADDR A:0x40002d0
y.create.l HWIO_MSS_XPU_RG2_SCR_ADDR A:0x4000350
y.create.l HWIO_MSS_XPU_RG3_SCR_ADDR A:0x40003d0
y.create.l HWIO_MSS_XPU_RG4_SCR_ADDR A:0x4000450
y.create.l HWIO_MSS_XPU_RG0_MCR_ADDR A:0x4000254
y.create.l HWIO_MSS_XPU_RG1_MCR_ADDR A:0x40002d4
y.create.l HWIO_MSS_XPU_RG2_MCR_ADDR A:0x4000354
y.create.l HWIO_MSS_XPU_RG3_MCR_ADDR A:0x40003d4
y.create.l HWIO_MSS_XPU_RG4_MCR_ADDR A:0x4000454
y.create.l HWIO_MSS_RELAY_MSG_BUFFER_00_ADDR A:0x4020000
y.create.l HWIO_MSS_RELAY_MSG_BUFFER_01_ADDR A:0x4020004
y.create.l HWIO_MSS_RELAY_MSG_BUFFER_02_ADDR A:0x4020008
y.create.l HWIO_MSS_RELAY_MSG_BUFFER_03_ADDR A:0x402000c
y.create.l HWIO_MSS_RELAY_MSG_BUFFER_04_ADDR A:0x4020010
y.create.l HWIO_MSS_RELAY_MSG_BUFFER_05_ADDR A:0x4020014
y.create.l HWIO_MSS_RELAY_MSG_BUFFER_06_ADDR A:0x4020018
y.create.l HWIO_MSS_RELAY_MSG_BUFFER_07_ADDR A:0x402001c
y.create.l HWIO_MSS_RELAY_MSG_BUFFER_08_ADDR A:0x4020020
y.create.l HWIO_MSS_RELAY_MSG_BUFFER_09_ADDR A:0x4020024
y.create.l HWIO_MSS_RELAY_MSG_BUFFER_10_ADDR A:0x4020028
y.create.l HWIO_MSS_RELAY_MSG_BUFFER_11_ADDR A:0x402002c
y.create.l HWIO_MSS_RELAY_MSG_BUFFER_12_ADDR A:0x4020030
y.create.l HWIO_MSS_RELAY_MSG_BUFFER_13_ADDR A:0x4020034
y.create.l HWIO_MSS_RELAY_MSG_BUFFER_14_ADDR A:0x4020038
y.create.l HWIO_MSS_RELAY_MSG_BUFFER_15_ADDR A:0x402003c
y.create.l HWIO_MSS_BAM_CTRL_ADDR A:0x4044000
y.create.l HWIO_MSS_BAM_TIMER_ADDR A:0x4044040
y.create.l HWIO_MSS_BAM_TIMER_CTRL_ADDR A:0x4044044
y.create.l HWIO_MSS_BAM_DESC_CNT_TRSHLD_ADDR A:0x4044008
y.create.l HWIO_MSS_BAM_IRQ_STTS_ADDR A:0x4044014
y.create.l HWIO_MSS_BAM_IRQ_CLR_ADDR A:0x4044018
y.create.l HWIO_MSS_BAM_IRQ_EN_ADDR A:0x404401c
y.create.l HWIO_MSS_BAM_CNFG_BITS_ADDR A:0x404407c
y.create.l HWIO_MSS_BAM_REVISION_ADDR A:0x4045000
y.create.l HWIO_MSS_BAM_SW_VERSION_ADDR A:0x4045004
y.create.l HWIO_MSS_BAM_NUM_PIPES_ADDR A:0x4045008
y.create.l HWIO_MSS_BAM_TEST_BUS_SEL_ADDR A:0x4045010
y.create.l HWIO_MSS_BAM_TEST_BUS_REG_ADDR A:0x4045014
y.create.l HWIO_MSS_BAM_AHB_MASTER_ERR_CTRLS_ADDR A:0x4045024
y.create.l HWIO_MSS_BAM_AHB_MASTER_ERR_ADDR_ADDR A:0x4045028
y.create.l HWIO_MSS_BAM_AHB_MASTER_ERR_DATA_ADDR A:0x404502c
y.create.l HWIO_MSS_BAM_AHB_MASTER_ERR_ADDR_LSB_ADDR A:0x4045100
y.create.l HWIO_MSS_BAM_AHB_MASTER_ERR_ADDR_MSB_ADDR A:0x4045104
y.create.l HWIO_MSS_BAM_TRUST_REG_ADDR A:0x4046000
y.create.l HWIO_MSS_BAM_P_TRUST_REG0_ADDR A:0x4046020
y.create.l HWIO_MSS_BAM_P_TRUST_REG1_ADDR A:0x4046024
y.create.l HWIO_MSS_BAM_P_TRUST_REG2_ADDR A:0x4046028
y.create.l HWIO_MSS_BAM_P_TRUST_REG3_ADDR A:0x404602c
y.create.l HWIO_MSS_BAM_P_TRUST_REG4_ADDR A:0x4046030
y.create.l HWIO_MSS_BAM_P_TRUST_REG5_ADDR A:0x4046034
y.create.l HWIO_MSS_BAM_IRQ_SRCS_EE0_ADDR A:0x4047000
y.create.l HWIO_MSS_BAM_IRQ_SRCS_EE1_ADDR A:0x4048000
y.create.l HWIO_MSS_BAM_IRQ_SRCS_EE2_ADDR A:0x4049000
y.create.l HWIO_MSS_BAM_IRQ_SRCS_EE3_ADDR A:0x404a000
y.create.l HWIO_MSS_BAM_IRQ_SRCS_EE4_ADDR A:0x404b000
y.create.l HWIO_MSS_BAM_IRQ_SRCS_EE5_ADDR A:0x404c000
y.create.l HWIO_MSS_BAM_IRQ_SRCS_EE6_ADDR A:0x404d000
y.create.l HWIO_MSS_BAM_IRQ_SRCS_EE7_ADDR A:0x404e000
y.create.l HWIO_MSS_BAM_IRQ_SRCS_MSK_EE0_ADDR A:0x4047004
y.create.l HWIO_MSS_BAM_IRQ_SRCS_MSK_EE1_ADDR A:0x4048004
y.create.l HWIO_MSS_BAM_IRQ_SRCS_MSK_EE2_ADDR A:0x4049004
y.create.l HWIO_MSS_BAM_IRQ_SRCS_MSK_EE3_ADDR A:0x404a004
y.create.l HWIO_MSS_BAM_IRQ_SRCS_MSK_EE4_ADDR A:0x404b004
y.create.l HWIO_MSS_BAM_IRQ_SRCS_MSK_EE5_ADDR A:0x404c004
y.create.l HWIO_MSS_BAM_IRQ_SRCS_MSK_EE6_ADDR A:0x404d004
y.create.l HWIO_MSS_BAM_IRQ_SRCS_MSK_EE7_ADDR A:0x404e004
y.create.l HWIO_MSS_BAM_IRQ_SRCS_UNMASKED_EE0_ADDR A:0x4047008
y.create.l HWIO_MSS_BAM_IRQ_SRCS_UNMASKED_EE1_ADDR A:0x4048008
y.create.l HWIO_MSS_BAM_IRQ_SRCS_UNMASKED_EE2_ADDR A:0x4049008
y.create.l HWIO_MSS_BAM_IRQ_SRCS_UNMASKED_EE3_ADDR A:0x404a008
y.create.l HWIO_MSS_BAM_IRQ_SRCS_UNMASKED_EE4_ADDR A:0x404b008
y.create.l HWIO_MSS_BAM_IRQ_SRCS_UNMASKED_EE5_ADDR A:0x404c008
y.create.l HWIO_MSS_BAM_IRQ_SRCS_UNMASKED_EE6_ADDR A:0x404d008
y.create.l HWIO_MSS_BAM_IRQ_SRCS_UNMASKED_EE7_ADDR A:0x404e008
y.create.l HWIO_MSS_BAM_PIPE_ATTR_EE0_ADDR A:0x404700c
y.create.l HWIO_MSS_BAM_PIPE_ATTR_EE1_ADDR A:0x404800c
y.create.l HWIO_MSS_BAM_PIPE_ATTR_EE2_ADDR A:0x404900c
y.create.l HWIO_MSS_BAM_PIPE_ATTR_EE3_ADDR A:0x404a00c
y.create.l HWIO_MSS_BAM_PIPE_ATTR_EE4_ADDR A:0x404b00c
y.create.l HWIO_MSS_BAM_PIPE_ATTR_EE5_ADDR A:0x404c00c
y.create.l HWIO_MSS_BAM_PIPE_ATTR_EE6_ADDR A:0x404d00c
y.create.l HWIO_MSS_BAM_PIPE_ATTR_EE7_ADDR A:0x404e00c
y.create.l HWIO_MSS_BAM_IRQ_SRCS_ADDR A:0x4047010
y.create.l HWIO_MSS_BAM_IRQ_SRCS_MSK_ADDR A:0x4047014
y.create.l HWIO_MSS_BAM_IRQ_SRCS_UNMASKED_ADDR A:0x4047018
y.create.l HWIO_MSS_BAM_P_CTRL0_ADDR A:0x4057000
y.create.l HWIO_MSS_BAM_P_CTRL1_ADDR A:0x4058000
y.create.l HWIO_MSS_BAM_P_CTRL2_ADDR A:0x4059000
y.create.l HWIO_MSS_BAM_P_CTRL3_ADDR A:0x405a000
y.create.l HWIO_MSS_BAM_P_CTRL4_ADDR A:0x405b000
y.create.l HWIO_MSS_BAM_P_CTRL5_ADDR A:0x405c000
y.create.l HWIO_MSS_BAM_P_RST0_ADDR A:0x4057004
y.create.l HWIO_MSS_BAM_P_RST1_ADDR A:0x4058004
y.create.l HWIO_MSS_BAM_P_RST2_ADDR A:0x4059004
y.create.l HWIO_MSS_BAM_P_RST3_ADDR A:0x405a004
y.create.l HWIO_MSS_BAM_P_RST4_ADDR A:0x405b004
y.create.l HWIO_MSS_BAM_P_RST5_ADDR A:0x405c004
y.create.l HWIO_MSS_BAM_P_HALT0_ADDR A:0x4057008
y.create.l HWIO_MSS_BAM_P_HALT1_ADDR A:0x4058008
y.create.l HWIO_MSS_BAM_P_HALT2_ADDR A:0x4059008
y.create.l HWIO_MSS_BAM_P_HALT3_ADDR A:0x405a008
y.create.l HWIO_MSS_BAM_P_HALT4_ADDR A:0x405b008
y.create.l HWIO_MSS_BAM_P_HALT5_ADDR A:0x405c008
y.create.l HWIO_MSS_BAM_P_IRQ_STTS0_ADDR A:0x4057010
y.create.l HWIO_MSS_BAM_P_IRQ_STTS1_ADDR A:0x4058010
y.create.l HWIO_MSS_BAM_P_IRQ_STTS2_ADDR A:0x4059010
y.create.l HWIO_MSS_BAM_P_IRQ_STTS3_ADDR A:0x405a010
y.create.l HWIO_MSS_BAM_P_IRQ_STTS4_ADDR A:0x405b010
y.create.l HWIO_MSS_BAM_P_IRQ_STTS5_ADDR A:0x405c010
y.create.l HWIO_MSS_BAM_P_IRQ_CLR0_ADDR A:0x4057014
y.create.l HWIO_MSS_BAM_P_IRQ_CLR1_ADDR A:0x4058014
y.create.l HWIO_MSS_BAM_P_IRQ_CLR2_ADDR A:0x4059014
y.create.l HWIO_MSS_BAM_P_IRQ_CLR3_ADDR A:0x405a014
y.create.l HWIO_MSS_BAM_P_IRQ_CLR4_ADDR A:0x405b014
y.create.l HWIO_MSS_BAM_P_IRQ_CLR5_ADDR A:0x405c014
y.create.l HWIO_MSS_BAM_P_IRQ_EN0_ADDR A:0x4057018
y.create.l HWIO_MSS_BAM_P_IRQ_EN1_ADDR A:0x4058018
y.create.l HWIO_MSS_BAM_P_IRQ_EN2_ADDR A:0x4059018
y.create.l HWIO_MSS_BAM_P_IRQ_EN3_ADDR A:0x405a018
y.create.l HWIO_MSS_BAM_P_IRQ_EN4_ADDR A:0x405b018
y.create.l HWIO_MSS_BAM_P_IRQ_EN5_ADDR A:0x405c018
y.create.l HWIO_MSS_BAM_P_TIMER0_ADDR A:0x405701c
y.create.l HWIO_MSS_BAM_P_TIMER1_ADDR A:0x405801c
y.create.l HWIO_MSS_BAM_P_TIMER2_ADDR A:0x405901c
y.create.l HWIO_MSS_BAM_P_TIMER3_ADDR A:0x405a01c
y.create.l HWIO_MSS_BAM_P_TIMER4_ADDR A:0x405b01c
y.create.l HWIO_MSS_BAM_P_TIMER5_ADDR A:0x405c01c
y.create.l HWIO_MSS_BAM_P_TIMER_CTRL0_ADDR A:0x4057020
y.create.l HWIO_MSS_BAM_P_TIMER_CTRL1_ADDR A:0x4058020
y.create.l HWIO_MSS_BAM_P_TIMER_CTRL2_ADDR A:0x4059020
y.create.l HWIO_MSS_BAM_P_TIMER_CTRL3_ADDR A:0x405a020
y.create.l HWIO_MSS_BAM_P_TIMER_CTRL4_ADDR A:0x405b020
y.create.l HWIO_MSS_BAM_P_TIMER_CTRL5_ADDR A:0x405c020
y.create.l HWIO_MSS_BAM_P_PRDCR_SDBND0_ADDR A:0x4057024
y.create.l HWIO_MSS_BAM_P_PRDCR_SDBND1_ADDR A:0x4058024
y.create.l HWIO_MSS_BAM_P_PRDCR_SDBND2_ADDR A:0x4059024
y.create.l HWIO_MSS_BAM_P_PRDCR_SDBND3_ADDR A:0x405a024
y.create.l HWIO_MSS_BAM_P_PRDCR_SDBND4_ADDR A:0x405b024
y.create.l HWIO_MSS_BAM_P_PRDCR_SDBND5_ADDR A:0x405c024
y.create.l HWIO_MSS_BAM_P_CNSMR_SDBND0_ADDR A:0x4057028
y.create.l HWIO_MSS_BAM_P_CNSMR_SDBND1_ADDR A:0x4058028
y.create.l HWIO_MSS_BAM_P_CNSMR_SDBND2_ADDR A:0x4059028
y.create.l HWIO_MSS_BAM_P_CNSMR_SDBND3_ADDR A:0x405a028
y.create.l HWIO_MSS_BAM_P_CNSMR_SDBND4_ADDR A:0x405b028
y.create.l HWIO_MSS_BAM_P_CNSMR_SDBND5_ADDR A:0x405c028
y.create.l HWIO_MSS_BAM_P_SW_OFSTS0_ADDR A:0x4057800
y.create.l HWIO_MSS_BAM_P_SW_OFSTS1_ADDR A:0x4058800
y.create.l HWIO_MSS_BAM_P_SW_OFSTS2_ADDR A:0x4059800
y.create.l HWIO_MSS_BAM_P_SW_OFSTS3_ADDR A:0x405a800
y.create.l HWIO_MSS_BAM_P_SW_OFSTS4_ADDR A:0x405b800
y.create.l HWIO_MSS_BAM_P_SW_OFSTS5_ADDR A:0x405c800
y.create.l HWIO_MSS_BAM_P_AU_PSM_CNTXT_1_0_ADDR A:0x4057804
y.create.l HWIO_MSS_BAM_P_AU_PSM_CNTXT_1_1_ADDR A:0x4058804
y.create.l HWIO_MSS_BAM_P_AU_PSM_CNTXT_1_2_ADDR A:0x4059804
y.create.l HWIO_MSS_BAM_P_AU_PSM_CNTXT_1_3_ADDR A:0x405a804
y.create.l HWIO_MSS_BAM_P_AU_PSM_CNTXT_1_4_ADDR A:0x405b804
y.create.l HWIO_MSS_BAM_P_AU_PSM_CNTXT_1_5_ADDR A:0x405c804
y.create.l HWIO_MSS_BAM_P_PSM_CNTXT_2_0_ADDR A:0x4057808
y.create.l HWIO_MSS_BAM_P_PSM_CNTXT_2_1_ADDR A:0x4058808
y.create.l HWIO_MSS_BAM_P_PSM_CNTXT_2_2_ADDR A:0x4059808
y.create.l HWIO_MSS_BAM_P_PSM_CNTXT_2_3_ADDR A:0x405a808
y.create.l HWIO_MSS_BAM_P_PSM_CNTXT_2_4_ADDR A:0x405b808
y.create.l HWIO_MSS_BAM_P_PSM_CNTXT_2_5_ADDR A:0x405c808
y.create.l HWIO_MSS_BAM_P_PSM_CNTXT_3_0_ADDR A:0x405780c
y.create.l HWIO_MSS_BAM_P_PSM_CNTXT_3_1_ADDR A:0x405880c
y.create.l HWIO_MSS_BAM_P_PSM_CNTXT_3_2_ADDR A:0x405980c
y.create.l HWIO_MSS_BAM_P_PSM_CNTXT_3_3_ADDR A:0x405a80c
y.create.l HWIO_MSS_BAM_P_PSM_CNTXT_3_4_ADDR A:0x405b80c
y.create.l HWIO_MSS_BAM_P_PSM_CNTXT_3_5_ADDR A:0x405c80c
y.create.l HWIO_MSS_BAM_P_PSM_CNTXT_4_0_ADDR A:0x4057810
y.create.l HWIO_MSS_BAM_P_PSM_CNTXT_4_1_ADDR A:0x4058810
y.create.l HWIO_MSS_BAM_P_PSM_CNTXT_4_2_ADDR A:0x4059810
y.create.l HWIO_MSS_BAM_P_PSM_CNTXT_4_3_ADDR A:0x405a810
y.create.l HWIO_MSS_BAM_P_PSM_CNTXT_4_4_ADDR A:0x405b810
y.create.l HWIO_MSS_BAM_P_PSM_CNTXT_4_5_ADDR A:0x405c810
y.create.l HWIO_MSS_BAM_P_PSM_CNTXT_5_0_ADDR A:0x4057814
y.create.l HWIO_MSS_BAM_P_PSM_CNTXT_5_1_ADDR A:0x4058814
y.create.l HWIO_MSS_BAM_P_PSM_CNTXT_5_2_ADDR A:0x4059814
y.create.l HWIO_MSS_BAM_P_PSM_CNTXT_5_3_ADDR A:0x405a814
y.create.l HWIO_MSS_BAM_P_PSM_CNTXT_5_4_ADDR A:0x405b814
y.create.l HWIO_MSS_BAM_P_PSM_CNTXT_5_5_ADDR A:0x405c814
y.create.l HWIO_MSS_BAM_P_EVNT_REG0_ADDR A:0x4057818
y.create.l HWIO_MSS_BAM_P_EVNT_REG1_ADDR A:0x4058818
y.create.l HWIO_MSS_BAM_P_EVNT_REG2_ADDR A:0x4059818
y.create.l HWIO_MSS_BAM_P_EVNT_REG3_ADDR A:0x405a818
y.create.l HWIO_MSS_BAM_P_EVNT_REG4_ADDR A:0x405b818
y.create.l HWIO_MSS_BAM_P_EVNT_REG5_ADDR A:0x405c818
y.create.l HWIO_MSS_BAM_P_DESC_FIFO_ADDR0_ADDR A:0x405781c
y.create.l HWIO_MSS_BAM_P_DESC_FIFO_ADDR1_ADDR A:0x405881c
y.create.l HWIO_MSS_BAM_P_DESC_FIFO_ADDR2_ADDR A:0x405981c
y.create.l HWIO_MSS_BAM_P_DESC_FIFO_ADDR3_ADDR A:0x405a81c
y.create.l HWIO_MSS_BAM_P_DESC_FIFO_ADDR4_ADDR A:0x405b81c
y.create.l HWIO_MSS_BAM_P_DESC_FIFO_ADDR5_ADDR A:0x405c81c
y.create.l HWIO_MSS_BAM_P_FIFO_SIZES0_ADDR A:0x4057820
y.create.l HWIO_MSS_BAM_P_FIFO_SIZES1_ADDR A:0x4058820
y.create.l HWIO_MSS_BAM_P_FIFO_SIZES2_ADDR A:0x4059820
y.create.l HWIO_MSS_BAM_P_FIFO_SIZES3_ADDR A:0x405a820
y.create.l HWIO_MSS_BAM_P_FIFO_SIZES4_ADDR A:0x405b820
y.create.l HWIO_MSS_BAM_P_FIFO_SIZES5_ADDR A:0x405c820
y.create.l HWIO_MSS_BAM_P_DATA_FIFO_ADDR0_ADDR A:0x4057824
y.create.l HWIO_MSS_BAM_P_DATA_FIFO_ADDR1_ADDR A:0x4058824
y.create.l HWIO_MSS_BAM_P_DATA_FIFO_ADDR2_ADDR A:0x4059824
y.create.l HWIO_MSS_BAM_P_DATA_FIFO_ADDR3_ADDR A:0x405a824
y.create.l HWIO_MSS_BAM_P_DATA_FIFO_ADDR4_ADDR A:0x405b824
y.create.l HWIO_MSS_BAM_P_DATA_FIFO_ADDR5_ADDR A:0x405c824
y.create.l HWIO_MSS_BAM_P_EVNT_GEN_TRSHLD0_ADDR A:0x4057828
y.create.l HWIO_MSS_BAM_P_EVNT_GEN_TRSHLD1_ADDR A:0x4058828
y.create.l HWIO_MSS_BAM_P_EVNT_GEN_TRSHLD2_ADDR A:0x4059828
y.create.l HWIO_MSS_BAM_P_EVNT_GEN_TRSHLD3_ADDR A:0x405a828
y.create.l HWIO_MSS_BAM_P_EVNT_GEN_TRSHLD4_ADDR A:0x405b828
y.create.l HWIO_MSS_BAM_P_EVNT_GEN_TRSHLD5_ADDR A:0x405c828
y.create.l HWIO_MSS_BAM_P_EVNT_DEST_ADDR0_ADDR A:0x405782c
y.create.l HWIO_MSS_BAM_P_EVNT_DEST_ADDR1_ADDR A:0x405882c
y.create.l HWIO_MSS_BAM_P_EVNT_DEST_ADDR2_ADDR A:0x405982c
y.create.l HWIO_MSS_BAM_P_EVNT_DEST_ADDR3_ADDR A:0x405a82c
y.create.l HWIO_MSS_BAM_P_EVNT_DEST_ADDR4_ADDR A:0x405b82c
y.create.l HWIO_MSS_BAM_P_EVNT_DEST_ADDR5_ADDR A:0x405c82c
y.create.l HWIO_MSS_BAM_P_DF_CNTXT_0_ADDR A:0x4057830
y.create.l HWIO_MSS_BAM_P_DF_CNTXT_1_ADDR A:0x4058830
y.create.l HWIO_MSS_BAM_P_DF_CNTXT_2_ADDR A:0x4059830
y.create.l HWIO_MSS_BAM_P_DF_CNTXT_3_ADDR A:0x405a830
y.create.l HWIO_MSS_BAM_P_DF_CNTXT_4_ADDR A:0x405b830
y.create.l HWIO_MSS_BAM_P_DF_CNTXT_5_ADDR A:0x405c830
y.create.l HWIO_MSS_BAM_P_RETR_CNTXT_0_ADDR A:0x4057834
y.create.l HWIO_MSS_BAM_P_RETR_CNTXT_1_ADDR A:0x4058834
y.create.l HWIO_MSS_BAM_P_RETR_CNTXT_2_ADDR A:0x4059834
y.create.l HWIO_MSS_BAM_P_RETR_CNTXT_3_ADDR A:0x405a834
y.create.l HWIO_MSS_BAM_P_RETR_CNTXT_4_ADDR A:0x405b834
y.create.l HWIO_MSS_BAM_P_RETR_CNTXT_5_ADDR A:0x405c834
y.create.l HWIO_MSS_BAM_P_SI_CNTXT_0_ADDR A:0x4057838
y.create.l HWIO_MSS_BAM_P_SI_CNTXT_1_ADDR A:0x4058838
y.create.l HWIO_MSS_BAM_P_SI_CNTXT_2_ADDR A:0x4059838
y.create.l HWIO_MSS_BAM_P_SI_CNTXT_3_ADDR A:0x405a838
y.create.l HWIO_MSS_BAM_P_SI_CNTXT_4_ADDR A:0x405b838
y.create.l HWIO_MSS_BAM_P_SI_CNTXT_5_ADDR A:0x405c838
y.create.l HWIO_MSS_BAM_P_PSM_CNTXT_3_LSB0_ADDR A:0x4057900
y.create.l HWIO_MSS_BAM_P_PSM_CNTXT_3_LSB1_ADDR A:0x4058900
y.create.l HWIO_MSS_BAM_P_PSM_CNTXT_3_LSB2_ADDR A:0x4059900
y.create.l HWIO_MSS_BAM_P_PSM_CNTXT_3_LSB3_ADDR A:0x405a900
y.create.l HWIO_MSS_BAM_P_PSM_CNTXT_3_LSB4_ADDR A:0x405b900
y.create.l HWIO_MSS_BAM_P_PSM_CNTXT_3_LSB5_ADDR A:0x405c900
y.create.l HWIO_MSS_BAM_P_PSM_CNTXT_3_MSB0_ADDR A:0x4057904
y.create.l HWIO_MSS_BAM_P_PSM_CNTXT_3_MSB1_ADDR A:0x4058904
y.create.l HWIO_MSS_BAM_P_PSM_CNTXT_3_MSB2_ADDR A:0x4059904
y.create.l HWIO_MSS_BAM_P_PSM_CNTXT_3_MSB3_ADDR A:0x405a904
y.create.l HWIO_MSS_BAM_P_PSM_CNTXT_3_MSB4_ADDR A:0x405b904
y.create.l HWIO_MSS_BAM_P_PSM_CNTXT_3_MSB5_ADDR A:0x405c904
y.create.l HWIO_MSS_BAM_P_DESC_FIFO_ADDR_LSB0_ADDR A:0x4057910
y.create.l HWIO_MSS_BAM_P_DESC_FIFO_ADDR_LSB1_ADDR A:0x4058910
y.create.l HWIO_MSS_BAM_P_DESC_FIFO_ADDR_LSB2_ADDR A:0x4059910
y.create.l HWIO_MSS_BAM_P_DESC_FIFO_ADDR_LSB3_ADDR A:0x405a910
y.create.l HWIO_MSS_BAM_P_DESC_FIFO_ADDR_LSB4_ADDR A:0x405b910
y.create.l HWIO_MSS_BAM_P_DESC_FIFO_ADDR_LSB5_ADDR A:0x405c910
y.create.l HWIO_MSS_BAM_P_DESC_FIFO_ADDR_MSB0_ADDR A:0x4057914
y.create.l HWIO_MSS_BAM_P_DESC_FIFO_ADDR_MSB1_ADDR A:0x4058914
y.create.l HWIO_MSS_BAM_P_DESC_FIFO_ADDR_MSB2_ADDR A:0x4059914
y.create.l HWIO_MSS_BAM_P_DESC_FIFO_ADDR_MSB3_ADDR A:0x405a914
y.create.l HWIO_MSS_BAM_P_DESC_FIFO_ADDR_MSB4_ADDR A:0x405b914
y.create.l HWIO_MSS_BAM_P_DESC_FIFO_ADDR_MSB5_ADDR A:0x405c914
y.create.l HWIO_MSS_BAM_P_DATA_FIFO_ADDR_LSB0_ADDR A:0x4057920
y.create.l HWIO_MSS_BAM_P_DATA_FIFO_ADDR_LSB1_ADDR A:0x4058920
y.create.l HWIO_MSS_BAM_P_DATA_FIFO_ADDR_LSB2_ADDR A:0x4059920
y.create.l HWIO_MSS_BAM_P_DATA_FIFO_ADDR_LSB3_ADDR A:0x405a920
y.create.l HWIO_MSS_BAM_P_DATA_FIFO_ADDR_LSB4_ADDR A:0x405b920
y.create.l HWIO_MSS_BAM_P_DATA_FIFO_ADDR_LSB5_ADDR A:0x405c920
y.create.l HWIO_MSS_BAM_P_DATA_FIFO_ADDR_MSB0_ADDR A:0x4057924
y.create.l HWIO_MSS_BAM_P_DATA_FIFO_ADDR_MSB1_ADDR A:0x4058924
y.create.l HWIO_MSS_BAM_P_DATA_FIFO_ADDR_MSB2_ADDR A:0x4059924
y.create.l HWIO_MSS_BAM_P_DATA_FIFO_ADDR_MSB3_ADDR A:0x405a924
y.create.l HWIO_MSS_BAM_P_DATA_FIFO_ADDR_MSB4_ADDR A:0x405b924
y.create.l HWIO_MSS_BAM_P_DATA_FIFO_ADDR_MSB5_ADDR A:0x405c924
y.create.l HWIO_MSS_BAM_P_EVNT_DEST_ADDR_LSB0_ADDR A:0x4057930
y.create.l HWIO_MSS_BAM_P_EVNT_DEST_ADDR_LSB1_ADDR A:0x4058930
y.create.l HWIO_MSS_BAM_P_EVNT_DEST_ADDR_LSB2_ADDR A:0x4059930
y.create.l HWIO_MSS_BAM_P_EVNT_DEST_ADDR_LSB3_ADDR A:0x405a930
y.create.l HWIO_MSS_BAM_P_EVNT_DEST_ADDR_LSB4_ADDR A:0x405b930
y.create.l HWIO_MSS_BAM_P_EVNT_DEST_ADDR_LSB5_ADDR A:0x405c930
y.create.l HWIO_MSS_BAM_P_EVNT_DEST_ADDR_MSB0_ADDR A:0x4057934
y.create.l HWIO_MSS_BAM_P_EVNT_DEST_ADDR_MSB1_ADDR A:0x4058934
y.create.l HWIO_MSS_BAM_P_EVNT_DEST_ADDR_MSB2_ADDR A:0x4059934
y.create.l HWIO_MSS_BAM_P_EVNT_DEST_ADDR_MSB3_ADDR A:0x405a934
y.create.l HWIO_MSS_BAM_P_EVNT_DEST_ADDR_MSB4_ADDR A:0x405b934
y.create.l HWIO_MSS_BAM_P_EVNT_DEST_ADDR_MSB5_ADDR A:0x405c934
y.create.l HWIO_MSS_QDSP6SS_VERSION_ADDR A:0x4080000
y.create.l HWIO_MSS_QDSP6SS_CONFIG_ID_ADDR A:0x4080004
y.create.l HWIO_MSS_QDSP6SS_RST_EVB_ADDR A:0x4080010
y.create.l HWIO_MSS_QDSP6SS_RESET_ADDR A:0x4080014
y.create.l HWIO_MSS_QDSP6SS_DBG_CFG_ADDR A:0x4080018
y.create.l HWIO_MSS_QDSP6SS_RET_CFG_ADDR A:0x408001c
y.create.l HWIO_MSS_QDSP6SS_GFMUX_CTL_ADDR A:0x4080020
y.create.l HWIO_MSS_QDSP6SS_GFMUX_STATUS_ADDR A:0x4080024
y.create.l HWIO_MSS_QDSP6SS_CORE_CMD_RCGR_ADDR A:0x4080028
y.create.l HWIO_MSS_QDSP6SS_CORE_CFG_RCGR_ADDR A:0x408002c
y.create.l HWIO_MSS_QDSP6SS_PWR_CTL_ADDR A:0x4080030
y.create.l HWIO_MSS_QDSP6SS_CGC_OVERRIDE_ADDR A:0x4080034
y.create.l HWIO_MSS_QDSP6SS_XO_CBCR_ADDR A:0x4080038
y.create.l HWIO_MSS_QDSP6SS_SLEEP_CBCR_ADDR A:0x408003c
y.create.l HWIO_MSS_QDSP6SS_NMI_ADDR A:0x4080040
y.create.l HWIO_MSS_QDSP6SS_NMI_STATUS_ADDR A:0x4080044
y.create.l HWIO_MSS_QDSP6SS_CLOCK_SPDM_MON_ADDR A:0x4080048
y.create.l HWIO_MSS_QDSP6SS_STATERET_CTL_ADDR A:0x408004c
y.create.l HWIO_MSS_QDSP6SS_LDO_CFG0_ADDR A:0x4080050
y.create.l HWIO_MSS_QDSP6SS_LDO_CFG1_ADDR A:0x4080054
y.create.l HWIO_MSS_QDSP6SS_LDO_CFG2_ADDR A:0x4080058
y.create.l HWIO_MSS_QDSP6SS_LDO_VREF_SET_ADDR A:0x408005c
y.create.l HWIO_MSS_QDSP6SS_LDO_VREF_TEST_CFG_ADDR A:0x4080060
y.create.l HWIO_MSS_QDSP6SS_LDO_VREF_CMD_ADDR A:0x4080064
y.create.l HWIO_MSS_QDSP6SS_QMC_SVS_CTL_ADDR A:0x4080068
y.create.l HWIO_MSS_QDSP6SS_BHS_STATUS_ADDR A:0x408006c
y.create.l HWIO_MSS_QDSP6SS_LDO_EFUSE_STATUS_ADDR A:0x4080070
y.create.l HWIO_MSS_QDSP6SS_BHS_CTL_ADDR A:0x4080074
y.create.l HWIO_MSS_QDSP6SS_SPM_SW_TRIG_ADDR A:0x4080080
y.create.l HWIO_MSS_QDSP6SS_SPM_TRIG_STATUS_ADDR A:0x4080084
y.create.l HWIO_MSS_QDSP6SS_INTF_HALTREQ_ADDR A:0x4080088
y.create.l HWIO_MSS_QDSP6SS_INTF_HALTACK_ADDR A:0x408008c
y.create.l HWIO_MSS_QDSP6SS_INTFCLAMP_SET_ADDR A:0x4080090
y.create.l HWIO_MSS_QDSP6SS_INTFCLAMP_CLEAR_ADDR A:0x4080094
y.create.l HWIO_MSS_QDSP6SS_INTFCLAMP_STATUS_ADDR A:0x4080098
y.create.l HWIO_MSS_QDSP6SS_INTF_FIFO_RESET_ADDR A:0x40800a0
y.create.l HWIO_MSS_QDSP6SS_CP_PWR_CTL_ADDR A:0x40800f0
y.create.l HWIO_MSS_QDSP6SS_CP_PWR_STATUS_ADDR A:0x40800f4
y.create.l HWIO_MSS_QDSP6SS_CP_RESET_ADDR A:0x40800f8
y.create.l HWIO_MSS_QDSP6SS_STRAP_TCM_ADDR A:0x4080100
y.create.l HWIO_MSS_QDSP6SS_STRAP_AHBUPPER_ADDR A:0x4080104
y.create.l HWIO_MSS_QDSP6SS_STRAP_AHBLOWER_ADDR A:0x4080108
y.create.l HWIO_MSS_QDSP6SS_STRAP_ACC_ADDR A:0x4080110
y.create.l HWIO_MSS_QDSP6SS_STRAP_QMC_ACC_ADDR A:0x4080114
y.create.l HWIO_MSS_QDSP6SS_DCC_CTRL_ADDR A:0x4080118
y.create.l HWIO_MSS_QDSP6SS_STRAP_AXIM2UPPER_ADDR A:0x408011c
y.create.l HWIO_MSS_QDSP6SS_STRAP_AXIM2LOWER_ADDR A:0x4080120
y.create.l HWIO_MSS_QDSP6SS_PLL_MODE_ADDR A:0x4080200
y.create.l HWIO_MSS_QDSP6SS_PLL_L_VAL_ADDR A:0x4080204
y.create.l HWIO_MSS_QDSP6SS_PLL_ALPHA_VAL_ADDR A:0x4080208
y.create.l HWIO_MSS_QDSP6SS_PLL_ALPHA_VAL_U_ADDR A:0x408020c
y.create.l HWIO_MSS_QDSP6SS_PLL_USER_CTL_ADDR A:0x4080210
y.create.l HWIO_MSS_QDSP6SS_PLL_USER_CTL_U_ADDR A:0x4080214
y.create.l HWIO_MSS_QDSP6SS_PLL_CONFIG_CTL_ADDR A:0x4080218
y.create.l HWIO_MSS_QDSP6SS_PLL_TEST_CTL_ADDR A:0x408021c
y.create.l HWIO_MSS_QDSP6SS_PLL_TEST_CTL_U_ADDR A:0x4080220
y.create.l HWIO_MSS_QDSP6SS_PLL_STATUS_ADDR A:0x4080224
y.create.l HWIO_MSS_QDSP6SS_PLL_FREQ_CTL_ADDR A:0x4080228
y.create.l HWIO_MSS_QDSP6SS_PLL_RCG_UPDATE_CFG_ADDR A:0x4080240
y.create.l HWIO_MSS_QDSP6SS_PLL_RCG_UPDATE_DLYCTL_ADDR A:0x4080244
y.create.l HWIO_MSS_QDSP6SS_PLL_RCG_UPDATE_CMD_ADDR A:0x4080248
y.create.l HWIO_MSS_QDSP6SS_PLL_RCG_UPDATE_STATUS_ADDR A:0x408023c
y.create.l HWIO_MSS_QDSP6SS_EXT_WAKEUP_ADDR A:0x4081000
y.create.l HWIO_MSS_QDSP6SS_EXT_PD_ADDR A:0x4081004
y.create.l HWIO_MSS_QDSP6SS_TEST_BUS_CTL_ADDR A:0x4082000
y.create.l HWIO_MSS_QDSP6SS_TEST_BUS_VALUE_ADDR A:0x4082004
y.create.l HWIO_MSS_QDSP6SS_TEST_BUS_WDATA_ADDR A:0x4082008
y.create.l HWIO_MSS_QDSP6SS_PWRDBG_CTL_ADDR A:0x408200c
y.create.l HWIO_MSS_QDSP6SS_TEST_CLK_CTL_ADDR A:0x4082010
y.create.l HWIO_MSS_QDSP6SS_PWRDBG_STATUS_ADDR A:0x4082014
y.create.l HWIO_MSS_QDSP6SS_ZMEAS_CONFIG_ADDR A:0x4082018
y.create.l HWIO_MSS_QDSP6SS_LDO_ATEST_ADDR A:0x408201c
y.create.l HWIO_MSS_QDSP6SS_LDO_DAC_STATUS_LOW_ADDR A:0x4082020
y.create.l HWIO_MSS_QDSP6SS_LDO_DAC_STATUS_HIGH_ADDR A:0x4082024
y.create.l HWIO_MSS_QDSP6SS_CORE_STATUS_ADDR A:0x4082028
y.create.l HWIO_QDSP6SS_INSTANCE_ID_ADDR A:0x4100000
y.create.l HWIO_QDSP6SS_IDLT_MATCH_VAL_ADDR A:0x4101000
y.create.l HWIO_QDSP6SS_IDLT_COUNT_VAL_ADDR A:0x4101004
y.create.l HWIO_QDSP6SS_IDLT_ENABLE_ADDR A:0x4101008
y.create.l HWIO_QDSP6SS_IDLT_SYNC_STATUS_ADDR A:0x410100c
y.create.l HWIO_QDSP6SS_WDOG_RESET_ADDR A:0x4102000
y.create.l HWIO_QDSP6SS_WDOG_CTL_ADDR A:0x4102004
y.create.l HWIO_QDSP6SS_WDOG_STATUS_ADDR A:0x4102008
y.create.l HWIO_QDSP6SS_WDOG_BARK_TIME_ADDR A:0x410200c
y.create.l HWIO_QDSP6SS_WDOG_BITE_TIME_ADDR A:0x4102010
y.create.l HWIO_QDSP6SS_WDOG_NMI_TIME_ADDR A:0x4102014
y.create.l HWIO_QDSP6SS_WDOG_TEST_LOAD_ADDR A:0x4102018
y.create.l HWIO_QDSP6SS_WDOG_TEST_ADDR A:0x410201c
y.create.l HWIO_QDSP6SS_IPC_ADDR A:0x4105000
y.create.l HWIO_QDSP6SS_L1_IRQ_BACKUP_EN_ADDR A:0x4105010
y.create.l HWIO_QDSP6SS_BLOCK_INTR_ADDR A:0x4107008
y.create.l HWIO_QDSP6SS_PD_HS_START_ADDR A:0x410700c
y.create.l HWIO_QDSP6SS_PD_HS_DONE_ADDR A:0x4107010
y.create.l HWIO_QDSP6SS_PU_HS_START_ADDR A:0x4107014
y.create.l HWIO_QDSP6SS_SLPC_CFG_ADDR A:0x410701c
y.create.l HWIO_QDSP6SS_SLPC_STATUS_ADDR A:0x4107020
y.create.l HWIO_QDSP6SS_MVC_PWR_REQ_ADDR A:0x4107030
y.create.l HWIO_QDSP6SS_SPM_EVENT_CTL_ADDR A:0x4107050
y.create.l HWIO_QDSP6SS_SPM_TRIG_CFG0_ADDR A:0x4107080
y.create.l HWIO_QDSP6SS_SPM_TRIG_CFG1_ADDR A:0x4107084
y.create.l HWIO_QDSP6SS_SPMCTL_EN_ARES_ADDR A:0x4107100
y.create.l HWIO_QDSP6SS_SPMCTL_EN_CLAMP_ADDR A:0x4107104
y.create.l HWIO_QDSP6SS_SPMCTL_EN_CLK_ADDR A:0x4107108
y.create.l HWIO_QDSP6SS_SPMCTL_EN_MEM_ADDR A:0x410710c
y.create.l HWIO_QDSP6SS_SPMCTL_EN_MEM_CP_ADDR A:0x4107110
y.create.l HWIO_QDSP6SS_SPMCTL_EN_BHS_ADDR A:0x4107114
y.create.l HWIO_QDSP6SS_SPMCTL_EN_LDO_ADDR A:0x4107118
y.create.l HWIO_QDSP6SS_SPMCTL_EN_EXT_ADDR A:0x410711c
y.create.l HWIO_QDSP6SS_SPMCTL_EN_PLL_ADDR A:0x4107120
y.create.l HWIO_QDSP6SS_SPMCTL_EN_STATERET_ADDR A:0x4107124
y.create.l HWIO_QDSP6SS_SPMCTL_EN_ISOINTF_CTL_ADDR A:0x4107128
y.create.l HWIO_QDSP6SS_SPMCTL_EN_ISOINTF_CLAMP_ADDR A:0x410712c
y.create.l HWIO_QDSP6SS_SPMCTL_EN_ISOINTF_CLK_ADDR A:0x4107130
y.create.l HWIO_QDSP6SS_SPMCTL_EN_ARES_SET_ADDR A:0x4107180
y.create.l HWIO_QDSP6SS_SPMCTL_EN_CLAMP_SET_ADDR A:0x4107184
y.create.l HWIO_QDSP6SS_SPMCTL_EN_CLK_SET_ADDR A:0x4107188
y.create.l HWIO_QDSP6SS_SPMCTL_EN_MEM_SET_ADDR A:0x410718c
y.create.l HWIO_QDSP6SS_SPMCTL_EN_MEM_CP_SET_ADDR A:0x4107190
y.create.l HWIO_QDSP6SS_SPMCTL_EN_BHS_SET_ADDR A:0x4107194
y.create.l HWIO_QDSP6SS_SPMCTL_EN_LDO_SET_ADDR A:0x4107198
y.create.l HWIO_QDSP6SS_SPMCTL_EN_EXT_SET_ADDR A:0x410719c
y.create.l HWIO_QDSP6SS_SPMCTL_EN_PLL_SET_ADDR A:0x41071a0
y.create.l HWIO_QDSP6SS_SPMCTL_EN_STATERET_SET_ADDR A:0x41071a4
y.create.l HWIO_QDSP6SS_SPMCTL_EN_ISOINTF_CTL_SET_ADDR A:0x41071a8
y.create.l HWIO_QDSP6SS_SPMCTL_EN_ISOINTF_CLAMP_SET_ADDR A:0x41071ac
y.create.l HWIO_QDSP6SS_SPMCTL_EN_ISOINTF_CLK_SET_ADDR A:0x41071b0
y.create.l HWIO_QDSP6SS_SPMCTL_EN_ARES_CLEAR_ADDR A:0x4107200
y.create.l HWIO_QDSP6SS_SPMCTL_EN_CLAMP_CLEAR_ADDR A:0x4107204
y.create.l HWIO_QDSP6SS_SPMCTL_EN_CLK_CLEAR_ADDR A:0x4107208
y.create.l HWIO_QDSP6SS_SPMCTL_EN_MEM_CLEAR_ADDR A:0x410720c
y.create.l HWIO_QDSP6SS_SPMCTL_EN_MEM_CP_CLEAR_ADDR A:0x4107210
y.create.l HWIO_QDSP6SS_SPMCTL_EN_BHS_CLEAR_ADDR A:0x4107214
y.create.l HWIO_QDSP6SS_SPMCTL_EN_LDO_CLEAR_ADDR A:0x4107218
y.create.l HWIO_QDSP6SS_SPMCTL_EN_EXT_CLEAR_ADDR A:0x410721c
y.create.l HWIO_QDSP6SS_SPMCTL_EN_PLL_CLEAR_ADDR A:0x4107220
y.create.l HWIO_QDSP6SS_SPMCTL_EN_STATERET_CLEAR_ADDR A:0x4107224
y.create.l HWIO_QDSP6SS_SPMCTL_EN_ISOINTF_CTL_CLEAR_ADDR A:0x4107228
y.create.l HWIO_QDSP6SS_SPMCTL_EN_ISOINTF_CLAMP_CLEAR_ADDR A:0x410722c
y.create.l HWIO_QDSP6SS_SPMCTL_EN_ISOINTF_CLK_CLEAR_ADDR A:0x4107230
y.create.l HWIO_QDSP6SS_L2VIC_VID_ADDR A:0x4110000
y.create.l HWIO_QDSP6SS_L2VIC_INT_ENABLE0_ADDR A:0x4110100
y.create.l HWIO_QDSP6SS_L2VIC_INT_ENABLE1_ADDR A:0x4110104
y.create.l HWIO_QDSP6SS_L2VIC_INT_ENABLE2_ADDR A:0x4110108
y.create.l HWIO_QDSP6SS_L2VIC_INT_ENABLE3_ADDR A:0x411010c
y.create.l HWIO_QDSP6SS_L2VIC_INT_ENABLE4_ADDR A:0x4110110
y.create.l HWIO_QDSP6SS_L2VIC_INT_ENABLE5_ADDR A:0x4110114
y.create.l HWIO_QDSP6SS_L2VIC_INT_ENABLE6_ADDR A:0x4110118
y.create.l HWIO_QDSP6SS_L2VIC_INT_ENABLE7_ADDR A:0x411011c
y.create.l HWIO_QDSP6SS_L2VIC_INT_ENABLE8_ADDR A:0x4110120
y.create.l HWIO_QDSP6SS_L2VIC_INT_ENABLE9_ADDR A:0x4110124
y.create.l HWIO_QDSP6SS_L2VIC_INT_ENABLE_CLEAR0_ADDR A:0x4110180
y.create.l HWIO_QDSP6SS_L2VIC_INT_ENABLE_CLEAR1_ADDR A:0x4110184
y.create.l HWIO_QDSP6SS_L2VIC_INT_ENABLE_CLEAR2_ADDR A:0x4110188
y.create.l HWIO_QDSP6SS_L2VIC_INT_ENABLE_CLEAR3_ADDR A:0x411018c
y.create.l HWIO_QDSP6SS_L2VIC_INT_ENABLE_CLEAR4_ADDR A:0x4110190
y.create.l HWIO_QDSP6SS_L2VIC_INT_ENABLE_CLEAR5_ADDR A:0x4110194
y.create.l HWIO_QDSP6SS_L2VIC_INT_ENABLE_CLEAR6_ADDR A:0x4110198
y.create.l HWIO_QDSP6SS_L2VIC_INT_ENABLE_CLEAR7_ADDR A:0x411019c
y.create.l HWIO_QDSP6SS_L2VIC_INT_ENABLE_CLEAR8_ADDR A:0x41101a0
y.create.l HWIO_QDSP6SS_L2VIC_INT_ENABLE_CLEAR9_ADDR A:0x41101a4
y.create.l HWIO_QDSP6SS_L2VIC_INT_ENABLE_SET0_ADDR A:0x4110200
y.create.l HWIO_QDSP6SS_L2VIC_INT_ENABLE_SET1_ADDR A:0x4110204
y.create.l HWIO_QDSP6SS_L2VIC_INT_ENABLE_SET2_ADDR A:0x4110208
y.create.l HWIO_QDSP6SS_L2VIC_INT_ENABLE_SET3_ADDR A:0x411020c
y.create.l HWIO_QDSP6SS_L2VIC_INT_ENABLE_SET4_ADDR A:0x4110210
y.create.l HWIO_QDSP6SS_L2VIC_INT_ENABLE_SET5_ADDR A:0x4110214
y.create.l HWIO_QDSP6SS_L2VIC_INT_ENABLE_SET6_ADDR A:0x4110218
y.create.l HWIO_QDSP6SS_L2VIC_INT_ENABLE_SET7_ADDR A:0x411021c
y.create.l HWIO_QDSP6SS_L2VIC_INT_ENABLE_SET8_ADDR A:0x4110220
y.create.l HWIO_QDSP6SS_L2VIC_INT_ENABLE_SET9_ADDR A:0x4110224
y.create.l HWIO_QDSP6SS_L2VIC_INT_TYPE0_ADDR A:0x4110280
y.create.l HWIO_QDSP6SS_L2VIC_INT_TYPE1_ADDR A:0x4110284
y.create.l HWIO_QDSP6SS_L2VIC_INT_TYPE2_ADDR A:0x4110288
y.create.l HWIO_QDSP6SS_L2VIC_INT_TYPE3_ADDR A:0x411028c
y.create.l HWIO_QDSP6SS_L2VIC_INT_TYPE4_ADDR A:0x4110290
y.create.l HWIO_QDSP6SS_L2VIC_INT_TYPE5_ADDR A:0x4110294
y.create.l HWIO_QDSP6SS_L2VIC_INT_TYPE6_ADDR A:0x4110298
y.create.l HWIO_QDSP6SS_L2VIC_INT_TYPE7_ADDR A:0x411029c
y.create.l HWIO_QDSP6SS_L2VIC_INT_TYPE8_ADDR A:0x41102a0
y.create.l HWIO_QDSP6SS_L2VIC_INT_TYPE9_ADDR A:0x41102a4
y.create.l HWIO_QDSP6SS_L2VIC_INT_STATUS0_ADDR A:0x4110380
y.create.l HWIO_QDSP6SS_L2VIC_INT_STATUS1_ADDR A:0x4110384
y.create.l HWIO_QDSP6SS_L2VIC_INT_STATUS2_ADDR A:0x4110388
y.create.l HWIO_QDSP6SS_L2VIC_INT_STATUS3_ADDR A:0x411038c
y.create.l HWIO_QDSP6SS_L2VIC_INT_STATUS4_ADDR A:0x4110390
y.create.l HWIO_QDSP6SS_L2VIC_INT_STATUS5_ADDR A:0x4110394
y.create.l HWIO_QDSP6SS_L2VIC_INT_STATUS6_ADDR A:0x4110398
y.create.l HWIO_QDSP6SS_L2VIC_INT_STATUS7_ADDR A:0x411039c
y.create.l HWIO_QDSP6SS_L2VIC_INT_STATUS8_ADDR A:0x41103a0
y.create.l HWIO_QDSP6SS_L2VIC_INT_STATUS9_ADDR A:0x41103a4
y.create.l HWIO_QDSP6SS_L2VIC_INT_CLEAR0_ADDR A:0x4110400
y.create.l HWIO_QDSP6SS_L2VIC_INT_CLEAR1_ADDR A:0x4110404
y.create.l HWIO_QDSP6SS_L2VIC_INT_CLEAR2_ADDR A:0x4110408
y.create.l HWIO_QDSP6SS_L2VIC_INT_CLEAR3_ADDR A:0x411040c
y.create.l HWIO_QDSP6SS_L2VIC_INT_CLEAR4_ADDR A:0x4110410
y.create.l HWIO_QDSP6SS_L2VIC_INT_CLEAR5_ADDR A:0x4110414
y.create.l HWIO_QDSP6SS_L2VIC_INT_CLEAR6_ADDR A:0x4110418
y.create.l HWIO_QDSP6SS_L2VIC_INT_CLEAR7_ADDR A:0x411041c
y.create.l HWIO_QDSP6SS_L2VIC_INT_CLEAR8_ADDR A:0x4110420
y.create.l HWIO_QDSP6SS_L2VIC_INT_CLEAR9_ADDR A:0x4110424
y.create.l HWIO_QDSP6SS_L2VIC_SOFT_INT0_ADDR A:0x4110480
y.create.l HWIO_QDSP6SS_L2VIC_SOFT_INT1_ADDR A:0x4110484
y.create.l HWIO_QDSP6SS_L2VIC_SOFT_INT2_ADDR A:0x4110488
y.create.l HWIO_QDSP6SS_L2VIC_SOFT_INT3_ADDR A:0x411048c
y.create.l HWIO_QDSP6SS_L2VIC_SOFT_INT4_ADDR A:0x4110490
y.create.l HWIO_QDSP6SS_L2VIC_SOFT_INT5_ADDR A:0x4110494
y.create.l HWIO_QDSP6SS_L2VIC_SOFT_INT6_ADDR A:0x4110498
y.create.l HWIO_QDSP6SS_L2VIC_SOFT_INT7_ADDR A:0x411049c
y.create.l HWIO_QDSP6SS_L2VIC_SOFT_INT8_ADDR A:0x41104a0
y.create.l HWIO_QDSP6SS_L2VIC_SOFT_INT9_ADDR A:0x41104a4
y.create.l HWIO_QDSP6SS_L2VIC_INT_PENDING0_ADDR A:0x4110500
y.create.l HWIO_QDSP6SS_L2VIC_INT_PENDING1_ADDR A:0x4110504
y.create.l HWIO_QDSP6SS_L2VIC_INT_PENDING2_ADDR A:0x4110508
y.create.l HWIO_QDSP6SS_L2VIC_INT_PENDING3_ADDR A:0x411050c
y.create.l HWIO_QDSP6SS_L2VIC_INT_PENDING4_ADDR A:0x4110510
y.create.l HWIO_QDSP6SS_L2VIC_INT_PENDING5_ADDR A:0x4110514
y.create.l HWIO_QDSP6SS_L2VIC_INT_PENDING6_ADDR A:0x4110518
y.create.l HWIO_QDSP6SS_L2VIC_INT_PENDING7_ADDR A:0x411051c
y.create.l HWIO_QDSP6SS_L2VIC_INT_PENDING8_ADDR A:0x4110520
y.create.l HWIO_QDSP6SS_L2VIC_INT_PENDING9_ADDR A:0x4110524
y.create.l HWIO_QDSP6SS_QTMR_AC_CNTFRQ_ADDR A:0x4120000
y.create.l HWIO_QDSP6SS_QTMR_AC_CNTSR_ADDR A:0x4120004
y.create.l HWIO_QDSP6SS_QTMR_AC_CNTTID_ADDR A:0x4120008
y.create.l HWIO_QDSP6SS_QTMR_AC_CNTACR_0_ADDR A:0x4120040
y.create.l HWIO_QDSP6SS_QTMR_AC_CNTACR_1_ADDR A:0x4120044
y.create.l HWIO_QDSP6SS_QTMR_AC_CNTACR_2_ADDR A:0x4120048
y.create.l HWIO_QDSP6SS_QTMR_AC_CNTVOFF_LO_0_ADDR A:0x4120080
y.create.l HWIO_QDSP6SS_QTMR_AC_CNTVOFF_LO_1_ADDR A:0x4120088
y.create.l HWIO_QDSP6SS_QTMR_AC_CNTVOFF_LO_2_ADDR A:0x4120090
y.create.l HWIO_QDSP6SS_QTMR_AC_CNTVOFF_HI_0_ADDR A:0x4120084
y.create.l HWIO_QDSP6SS_QTMR_AC_CNTVOFF_HI_1_ADDR A:0x412008c
y.create.l HWIO_QDSP6SS_QTMR_AC_CNTVOFF_HI_2_ADDR A:0x4120094
y.create.l HWIO_QDSP6SS_QTMR_AC_CFG_ADDR A:0x4120fc0
y.create.l HWIO_QDSP6SS_QTMR_AC_VERSION_ADDR A:0x4120fd0
y.create.l HWIO_QDSP6SS_QTMR_V1_CNTPCT_LO_0_ADDR A:0x4121000
y.create.l HWIO_QDSP6SS_QTMR_V1_CNTPCT_HI_0_ADDR A:0x4121004
y.create.l HWIO_QDSP6SS_QTMR_V1_CNTVCT_LO_0_ADDR A:0x4121008
y.create.l HWIO_QDSP6SS_QTMR_V1_CNTVCT_HI_0_ADDR A:0x412100c
y.create.l HWIO_QDSP6SS_QTMR_V1_CNTFRQ_0_ADDR A:0x4121010
y.create.l HWIO_QDSP6SS_QTMR_V1_CNTPL0ACR_0_ADDR A:0x4121014
y.create.l HWIO_QDSP6SS_QTMR_V1_CNTVOFF_LO_0_ADDR A:0x4121018
y.create.l HWIO_QDSP6SS_QTMR_V1_CNTVOFF_HI_0_ADDR A:0x412101c
y.create.l HWIO_QDSP6SS_QTMR_V1_CNTP_CVAL_LO_0_ADDR A:0x4121020
y.create.l HWIO_QDSP6SS_QTMR_V1_CNTP_CVAL_HI_0_ADDR A:0x4121024
y.create.l HWIO_QDSP6SS_QTMR_V1_CNTP_TVAL_0_ADDR A:0x4121028
y.create.l HWIO_QDSP6SS_QTMR_V1_CNTP_CTL_0_ADDR A:0x412102c
y.create.l HWIO_QDSP6SS_QTMR_V1_CNTV_CVAL_LO_0_ADDR A:0x4121030
y.create.l HWIO_QDSP6SS_QTMR_V1_CNTV_CVAL_HI_0_ADDR A:0x4121034
y.create.l HWIO_QDSP6SS_QTMR_V1_CNTV_TVAL_0_ADDR A:0x4121038
y.create.l HWIO_QDSP6SS_QTMR_V1_CNTV_CTL_0_ADDR A:0x412103c
y.create.l HWIO_QDSP6SS_QTMR_V1_VERSION_0_ADDR A:0x4121fd0
y.create.l HWIO_QDSP6SS_QTMR_V1_CNTPCT_LO_1_ADDR A:0x4122000
y.create.l HWIO_QDSP6SS_QTMR_V1_CNTPCT_HI_1_ADDR A:0x4122004
y.create.l HWIO_QDSP6SS_QTMR_V1_CNTVCT_LO_1_ADDR A:0x4122008
y.create.l HWIO_QDSP6SS_QTMR_V1_CNTVCT_HI_1_ADDR A:0x412200c
y.create.l HWIO_QDSP6SS_QTMR_V1_CNTFRQ_1_ADDR A:0x4122010
y.create.l HWIO_QDSP6SS_QTMR_V1_CNTPL0ACR_1_ADDR A:0x4122014
y.create.l HWIO_QDSP6SS_QTMR_V1_CNTVOFF_LO_1_ADDR A:0x4122018
y.create.l HWIO_QDSP6SS_QTMR_V1_CNTVOFF_HI_1_ADDR A:0x412201c
y.create.l HWIO_QDSP6SS_QTMR_V1_CNTP_CVAL_LO_1_ADDR A:0x4122020
y.create.l HWIO_QDSP6SS_QTMR_V1_CNTP_CVAL_HI_1_ADDR A:0x4122024
y.create.l HWIO_QDSP6SS_QTMR_V1_CNTP_TVAL_1_ADDR A:0x4122028
y.create.l HWIO_QDSP6SS_QTMR_V1_CNTP_CTL_1_ADDR A:0x412202c
y.create.l HWIO_QDSP6SS_QTMR_V1_CNTV_CVAL_LO_1_ADDR A:0x4122030
y.create.l HWIO_QDSP6SS_QTMR_V1_CNTV_CVAL_HI_1_ADDR A:0x4122034
y.create.l HWIO_QDSP6SS_QTMR_V1_CNTV_TVAL_1_ADDR A:0x4122038
y.create.l HWIO_QDSP6SS_QTMR_V1_CNTV_CTL_1_ADDR A:0x412203c
y.create.l HWIO_QDSP6SS_QTMR_V1_VERSION_1_ADDR A:0x4122fd0
y.create.l HWIO_QDSP6SS_QTMR_V1_CNTPCT_LO_2_ADDR A:0x4123000
y.create.l HWIO_QDSP6SS_QTMR_V1_CNTPCT_HI_2_ADDR A:0x4123004
y.create.l HWIO_QDSP6SS_QTMR_V1_CNTVCT_LO_2_ADDR A:0x4123008
y.create.l HWIO_QDSP6SS_QTMR_V1_CNTVCT_HI_2_ADDR A:0x412300c
y.create.l HWIO_QDSP6SS_QTMR_V1_CNTFRQ_2_ADDR A:0x4123010
y.create.l HWIO_QDSP6SS_QTMR_V1_CNTPL0ACR_2_ADDR A:0x4123014
y.create.l HWIO_QDSP6SS_QTMR_V1_CNTVOFF_LO_2_ADDR A:0x4123018
y.create.l HWIO_QDSP6SS_QTMR_V1_CNTVOFF_HI_2_ADDR A:0x412301c
y.create.l HWIO_QDSP6SS_QTMR_V1_CNTP_CVAL_LO_2_ADDR A:0x4123020
y.create.l HWIO_QDSP6SS_QTMR_V1_CNTP_CVAL_HI_2_ADDR A:0x4123024
y.create.l HWIO_QDSP6SS_QTMR_V1_CNTP_TVAL_2_ADDR A:0x4123028
y.create.l HWIO_QDSP6SS_QTMR_V1_CNTP_CTL_2_ADDR A:0x412302c
y.create.l HWIO_QDSP6SS_QTMR_V1_CNTV_CVAL_LO_2_ADDR A:0x4123030
y.create.l HWIO_QDSP6SS_QTMR_V1_CNTV_CVAL_HI_2_ADDR A:0x4123034
y.create.l HWIO_QDSP6SS_QTMR_V1_CNTV_TVAL_2_ADDR A:0x4123038
y.create.l HWIO_QDSP6SS_QTMR_V1_CNTV_CTL_2_ADDR A:0x412303c
y.create.l HWIO_QDSP6SS_QTMR_V1_VERSION_2_ADDR A:0x4123fd0
y.create.l HWIO_QDSP6SS_SAW2_SECURE_ADDR A:0x4130000
y.create.l HWIO_QDSP6SS_SAW2_ID_ADDR A:0x4130004
y.create.l HWIO_QDSP6SS_SAW2_CFG_ADDR A:0x4130008
y.create.l HWIO_QDSP6SS_SAW2_SPM_STS_ADDR A:0x413000c
y.create.l HWIO_QDSP6SS_SAW2_AVS_STS_ADDR A:0x4130010
y.create.l HWIO_QDSP6SS_SAW2_PMIC_STS_ADDR A:0x4130014
y.create.l HWIO_QDSP6SS_SAW2_RST_ADDR A:0x4130018
y.create.l HWIO_QDSP6SS_SAW2_SPM_CTL_ADDR A:0x4130030
y.create.l HWIO_QDSP6SS_SAW2_SPM_DLY_ADDR A:0x4130034
y.create.l HWIO_QDSP6SS_SAW2_SPM_STS2_ADDR A:0x4130038
y.create.l HWIO_QDSP6SS_SAW2_SPM_SLP_SEQ_ENTRY_0_ADDR A:0x4130400
y.create.l HWIO_QDSP6SS_SAW2_SPM_SLP_SEQ_ENTRY_1_ADDR A:0x4130404
y.create.l HWIO_QDSP6SS_SAW2_SPM_SLP_SEQ_ENTRY_2_ADDR A:0x4130408
y.create.l HWIO_QDSP6SS_SAW2_SPM_SLP_SEQ_ENTRY_3_ADDR A:0x413040c
y.create.l HWIO_QDSP6SS_SAW2_SPM_SLP_SEQ_ENTRY_4_ADDR A:0x4130410
y.create.l HWIO_QDSP6SS_SAW2_SPM_SLP_SEQ_ENTRY_5_ADDR A:0x4130414
y.create.l HWIO_QDSP6SS_SAW2_SPM_SLP_SEQ_ENTRY_6_ADDR A:0x4130418
y.create.l HWIO_QDSP6SS_SAW2_SPM_SLP_SEQ_ENTRY_7_ADDR A:0x413041c
y.create.l HWIO_QDSP6SS_SAW2_SPM_SLP_SEQ_ENTRY_8_ADDR A:0x4130420
y.create.l HWIO_QDSP6SS_SAW2_SPM_SLP_SEQ_ENTRY_9_ADDR A:0x4130424
y.create.l HWIO_QDSP6SS_SAW2_VERSION_ADDR A:0x4130fd0
y.create.l HWIO_MSS_ENABLE_ADDR A:0x4180000
y.create.l HWIO_MSS_CLAMP_MEM_ADDR A:0x4180004
y.create.l HWIO_MSS_CLAMP_IO_ADDR A:0x4180008
y.create.l HWIO_MSS_BUS_AHB2AHB_CFG_ADDR A:0x418000c
y.create.l HWIO_MSS_BUS_MAXI2AXI_CFG_ADDR A:0x4180010
y.create.l HWIO_MSS_CUSTOM_MEM_ARRSTBYN_ADDR A:0x4180014
y.create.l HWIO_MSS_ANALOG_IP_TEST_CTL_ADDR A:0x4180018
y.create.l HWIO_MSS_ATB_ID_ADDR A:0x418001c
y.create.l HWIO_MSS_DBG_BUS_CTL_ADDR A:0x4180020
y.create.l HWIO_MSS_AHB_ACCESS_ERR_IRQ_EN_ADDR A:0x4180024
y.create.l HWIO_MSS_AHB_ACCESS_ERR_IRQ_STATUS_ADDR A:0x4180028
y.create.l HWIO_MSS_AHB_ACCESS_ERR_IRQ_CLR_ADDR A:0x418002c
y.create.l HWIO_MSS_BUS_CTL_CFG_ADDR A:0x4180030
y.create.l HWIO_MSS_MSA_ADDR A:0x4180058
y.create.l HWIO_MSS_HW_VERSION_ADDR A:0x418005c
y.create.l HWIO_MSS_MODEM_MEM_SLP_CNTL_ADDR A:0x4180060
y.create.l HWIO_MSS_CLOCK_SPDM_MON_ADDR A:0x4180064
y.create.l HWIO_MSS_BBRX0_MUX_SEL_ADDR A:0x4180068
y.create.l HWIO_MSS_BBRX1_MUX_SEL_ADDR A:0x418006c
y.create.l HWIO_MSS_BBRX2_MUX_SEL_ADDR A:0x4180070
y.create.l HWIO_MSS_BBRX3_MUX_SEL_ADDR A:0x4180074
y.create.l HWIO_MSS_DEBUG_CLOCK_CTL_ADDR A:0x4180078
y.create.l HWIO_MSS_BBRX_EXT_CLOCK_MUX_SEL_ADDR A:0x418007c
y.create.l HWIO_MSS_BBRX_CTL_ADDR A:0x4180094
y.create.l HWIO_MSS_DEBUG_CTL_ADDR A:0x4180098
y.create.l HWIO_MSS_POWER_ADDR A:0x418009c
y.create.l HWIO_MSS_MSA_NC_HM_ADDR A:0x41800a0
y.create.l HWIO_MSS_CXM_ADDR A:0x41800a4
y.create.l HWIO_MSS_RELAY_MSG_SHADOW_00_ADDR A:0x4180400
y.create.l HWIO_MSS_RELAY_MSG_SHADOW_01_ADDR A:0x4180404
y.create.l HWIO_MSS_RELAY_MSG_SHADOW_02_ADDR A:0x4180408
y.create.l HWIO_MSS_RELAY_MSG_SHADOW_03_ADDR A:0x418040c
y.create.l HWIO_MSS_RELAY_MSG_SHADOW_04_ADDR A:0x4180410
y.create.l HWIO_MSS_RELAY_MSG_SHADOW_05_ADDR A:0x4180414
y.create.l HWIO_MSS_RELAY_MSG_SHADOW_06_ADDR A:0x4180418
y.create.l HWIO_MSS_RELAY_MSG_SHADOW_07_ADDR A:0x418041c
y.create.l HWIO_MSS_RELAY_MSG_SHADOW_08_ADDR A:0x4180420
y.create.l HWIO_MSS_RELAY_MSG_SHADOW_09_ADDR A:0x4180424
y.create.l HWIO_MSS_RELAY_MSG_SHADOW_10_ADDR A:0x4180428
y.create.l HWIO_MSS_RELAY_MSG_SHADOW_11_ADDR A:0x418042c
y.create.l HWIO_MSS_RELAY_MSG_SHADOW_12_ADDR A:0x4180430
y.create.l HWIO_MSS_RELAY_MSG_SHADOW_13_ADDR A:0x4180434
y.create.l HWIO_MSS_RELAY_MSG_SHADOW_14_ADDR A:0x4180438
y.create.l HWIO_MSS_RELAY_MSG_SHADOW_15_ADDR A:0x418043c
y.create.l HWIO_MSS_MPLL1_MODE_ADDR A:0x4181020
y.create.l HWIO_MSS_MPLL1_L_VAL_ADDR A:0x4181024
y.create.l HWIO_MSS_MPLL1_M_VAL_ADDR A:0x4181028
y.create.l HWIO_MSS_MPLL1_N_VAL_ADDR A:0x418102c
y.create.l HWIO_MSS_MPLL1_USER_CTL_ADDR A:0x4181030
y.create.l HWIO_MSS_MPLL1_CONFIG_CTL_ADDR A:0x4181034
y.create.l HWIO_MSS_MPLL1_TEST_CTL_ADDR A:0x4181038
y.create.l HWIO_MSS_MPLL1_STATUS_ADDR A:0x418103c
y.create.l HWIO_MSS_UIM0_BCR_ADDR A:0x4181060
y.create.l HWIO_MSS_UIM1_BCR_ADDR A:0x4181064
y.create.l HWIO_MSS_Q6SS_BCR_ADDR A:0x4181068
y.create.l HWIO_MSS_NAV_CE_BRIDGE_BCR_ADDR A:0x418106c
y.create.l HWIO_MSS_CRYPTO_BCR_ADDR A:0x4181070
y.create.l HWIO_MSS_NAV_BCR_ADDR A:0x4181074
y.create.l HWIO_MSS_UIM0_CBCR_ADDR A:0x4181078
y.create.l HWIO_MSS_UIM1_CBCR_ADDR A:0x418107c
y.create.l HWIO_MSS_XO_UIM0_CBCR_ADDR A:0x4181080
y.create.l HWIO_MSS_XO_UIM1_CBCR_ADDR A:0x4181084
y.create.l HWIO_MSS_XO_MODEM_CBCR_ADDR A:0x4181088
y.create.l HWIO_MSS_BUS_UIM0_CBCR_ADDR A:0x4181090
y.create.l HWIO_MSS_BUS_UIM1_CBCR_ADDR A:0x4181094
y.create.l HWIO_MSS_BUS_CSR_CBCR_ADDR A:0x4181098
y.create.l HWIO_MSS_BUS_BRIDGE_CBCR_ADDR A:0x418109c
y.create.l HWIO_MSS_BUS_MODEM_CBCR_ADDR A:0x41810a0
y.create.l HWIO_MSS_BUS_Q6_CBCR_ADDR A:0x41810a4
y.create.l HWIO_MSS_BUS_NAV_CE_BRIDGE_CBCR_ADDR A:0x41810a8
y.create.l HWIO_MSS_BUS_CRYPTO_CBCR_ADDR A:0x41810ac
y.create.l HWIO_MSS_BUS_NAV_CBCR_ADDR A:0x41810b0
y.create.l HWIO_MSS_BUS_ATB_CBCR_ADDR A:0x41810b8
y.create.l HWIO_MSS_BUS_MODEM_BRIDGE_CX_CBCR_ADDR A:0x41810c0
y.create.l HWIO_MSS_BUS_SLAVE_TIMEOUT_CBCR_ADDR A:0x41810c4
y.create.l HWIO_MSS_BUS_COMBODAC_COMP_CBCR_ADDR A:0x41810cc
y.create.l HWIO_MSS_MODEM_CFG_AHB_CBCR_ADDR A:0x41810d4
y.create.l HWIO_MSS_MODEM_SNOC_AXI_CBCR_ADDR A:0x41810d8
y.create.l HWIO_MSS_NAV_SNOC_AXI_CBCR_ADDR A:0x41810dc
y.create.l HWIO_MSS_MPLL2_MAIN_BUS_CBCR_ADDR A:0x41810e0
y.create.l HWIO_MSS_MPLL1_MAIN_CBCR_ADDR A:0x41810e8
y.create.l HWIO_MSS_MPLL1_MAIN_BUS_CBCR_ADDR A:0x41810ec
y.create.l HWIO_MSS_MPLL1_EARLY_DIV5_CBCR_ADDR A:0x41810f0
y.create.l HWIO_MSS_MPLL1_EARLY_DIV3_CBCR_ADDR A:0x41810f4
y.create.l HWIO_MSS_MPLL1_OUT_EARLY_DIV3_CBCR_ADDR A:0x4181100
y.create.l HWIO_MSS_MPLL1_OUT_EARLY_DIV5_CBCR_ADDR A:0x4181104
y.create.l HWIO_MSS_BUS_CMD_RCGR_ADDR A:0x4181108
y.create.l HWIO_MSS_BUS_CFG_RCGR_ADDR A:0x418110c
y.create.l HWIO_MSS_Q6_CMD_RCGR_ADDR A:0x4181110
y.create.l HWIO_MSS_Q6_CFG_RCGR_ADDR A:0x4181114
y.create.l HWIO_MSS_UIM_CMD_RCGR_ADDR A:0x4181118
y.create.l HWIO_MSS_UIM_CFG_RCGR_ADDR A:0x418111c
y.create.l HWIO_MSS_BBRX0_CBCR_ADDR A:0x4181120
y.create.l HWIO_MSS_BBRX1_CBCR_ADDR A:0x4181124
y.create.l HWIO_MSS_BBRX2_CBCR_ADDR A:0x4181128
y.create.l HWIO_MSS_BBRX3_CBCR_ADDR A:0x418112c
y.create.l HWIO_MSS_BIMC_THROTTLE_ADDR A:0x4181130
y.create.l HWIO_MSS_RESERVE_02_ADDR A:0x4181134
y.create.l HWIO_MSS_BBRX0_MISC_ADDR A:0x4181138
y.create.l HWIO_MSS_BBRX1_MISC_ADDR A:0x418113c
y.create.l HWIO_MSS_BBRX2_MISC_ADDR A:0x4181140
y.create.l HWIO_MSS_BBRX3_MISC_ADDR A:0x4181144
y.create.l HWIO_MSS_UIM0_MND_CMD_RCGR_ADDR A:0x4181150
y.create.l HWIO_MSS_UIM0_MND_CFG_RCGR_ADDR A:0x4181154
y.create.l HWIO_MSS_UIM0_MND_M_ADDR A:0x4181158
y.create.l HWIO_MSS_UIM0_MND_N_ADDR A:0x418115c
y.create.l HWIO_MSS_UIM0_MND_D_ADDR A:0x4181160
y.create.l HWIO_MSS_UIM1_MND_CMD_RCGR_ADDR A:0x4181164
y.create.l HWIO_MSS_UIM1_MND_CFG_RCGR_ADDR A:0x4181168
y.create.l HWIO_MSS_UIM1_MND_M_ADDR A:0x418116c
y.create.l HWIO_MSS_UIM1_MND_N_ADDR A:0x4181170
y.create.l HWIO_MSS_UIM1_MND_D_ADDR A:0x4181174
y.create.l HWIO_MSS_UIM2_BCR_ADDR A:0x4181178
y.create.l HWIO_MSS_UIM2_CBCR_ADDR A:0x418117c
y.create.l HWIO_MSS_XO_UIM2_CBCR_ADDR A:0x4181180
y.create.l HWIO_MSS_BUS_UIM2_CBCR_ADDR A:0x4181184
y.create.l HWIO_MSS_UIM2_MND_CMD_RCGR_ADDR A:0x4181188
y.create.l HWIO_MSS_UIM2_MND_CFG_RCGR_ADDR A:0x418118c
y.create.l HWIO_MSS_UIM2_MND_M_ADDR A:0x4181190
y.create.l HWIO_MSS_UIM2_MND_N_ADDR A:0x4181194
y.create.l HWIO_MSS_UIM2_MND_D_ADDR A:0x4181198
y.create.l HWIO_MSS_BUS_MGPI_CBCR_ADDR A:0x418119c
y.create.l HWIO_MSS_MGPI_BCR_ADDR A:0x41811a0
y.create.l HWIO_MSS_TCSR_ACC_SEL_ADDR A:0x418f000
y.create.l HWIO_MSS_UIM0_UART_DM_MR1_ADDR A:0x4190000
y.create.l HWIO_MSS_UIM0_UART_DM_MR2_ADDR A:0x4190004
y.create.l HWIO_MSS_UIM0_UART_DM_CSR_SR_DEPRECATED_ADDR A:0x4190008
y.create.l HWIO_MSS_UIM0_UART_DM_CR_MISR_DEPRECATED_ADDR A:0x4190010
y.create.l HWIO_MSS_UIM0_UART_DM_IMR_ISR_DEPRECATED_ADDR A:0x4190014
y.create.l HWIO_MSS_UIM0_UART_DM_IPR_ADDR A:0x4190018
y.create.l HWIO_MSS_UIM0_UART_DM_TFWR_ADDR A:0x419001c
y.create.l HWIO_MSS_UIM0_UART_DM_RFWR_ADDR A:0x4190020
y.create.l HWIO_MSS_UIM0_UART_DM_HCR_ADDR A:0x4190024
y.create.l HWIO_MSS_UIM0_UART_DM_DMRX_ADDR A:0x4190034
y.create.l HWIO_MSS_UIM0_UART_DM_IRDA_RX_TOTAL_SNAP_DEPRECATED_ADDR A:0x4190038
y.create.l HWIO_MSS_UIM0_UART_DM_DMEN_ADDR A:0x419003c
y.create.l HWIO_MSS_UIM0_UART_DM_NO_CHARS_FOR_TX_ADDR A:0x4190040
y.create.l HWIO_MSS_UIM0_UART_DM_BADR_ADDR A:0x4190044
y.create.l HWIO_MSS_UIM0_UART_DM_TESTSL_ADDR A:0x4190048
y.create.l HWIO_MSS_UIM0_UART_DM_TXFS_ADDR A:0x419004c
y.create.l HWIO_MSS_UIM0_UART_DM_RXFS_ADDR A:0x4190050
y.create.l HWIO_MSS_UIM0_UART_DM_MISR_MODE_ADDR A:0x4190060
y.create.l HWIO_MSS_UIM0_UART_DM_MISR_RESET_ADDR A:0x4190064
y.create.l HWIO_MSS_UIM0_UART_DM_MISR_EXPORT_ADDR A:0x4190068
y.create.l HWIO_MSS_UIM0_UART_DM_MISR_VAL_ADDR A:0x419006c
y.create.l HWIO_MSS_UIM0_UART_DM_TF_RF_DEPRECATED_ADDR A:0x4190070
y.create.l HWIO_MSS_UIM0_UART_DM_TF_RF_2_DEPRECATED_ADDR A:0x4190074
y.create.l HWIO_MSS_UIM0_UART_DM_TF_RF_3_DEPRECATED_ADDR A:0x4190078
y.create.l HWIO_MSS_UIM0_UART_DM_TF_RF_4_DEPRECATED_ADDR A:0x419007c
y.create.l HWIO_MSS_UIM0_UART_DM_SIM_CFG_ADDR A:0x4190080
y.create.l HWIO_MSS_UIM0_UART_DM_TEST_WR_ADDR_ADDR A:0x4190084
y.create.l HWIO_MSS_UIM0_UART_DM_TEST_WR_DATA_ADDR A:0x4190088
y.create.l HWIO_MSS_UIM0_UART_DM_TEST_RD_ADDR_ADDR A:0x419008c
y.create.l HWIO_MSS_UIM0_UART_DM_TEST_RD_DATA_ADDR A:0x4190090
y.create.l HWIO_MSS_UIM0_UART_DM_CSR_ADDR A:0x41900a0
y.create.l HWIO_MSS_UIM0_UART_DM_SR_ADDR A:0x41900a4
y.create.l HWIO_MSS_UIM0_UART_DM_CR_ADDR A:0x41900a8
y.create.l HWIO_MSS_UIM0_UART_DM_MISR_ADDR A:0x41900ac
y.create.l HWIO_MSS_UIM0_UART_DM_IMR_ADDR A:0x41900b0
y.create.l HWIO_MSS_UIM0_UART_DM_ISR_ADDR A:0x41900b4
y.create.l HWIO_MSS_UIM0_UART_DM_IRDA_ADDR A:0x41900b8
y.create.l HWIO_MSS_UIM0_UART_DM_RX_TOTAL_SNAP_ADDR A:0x41900bc
y.create.l HWIO_MSS_UIM0_UART_DM_WWT_TIMEOUT_ADDR A:0x41900c0
y.create.l HWIO_MSS_UIM0_UART_DM_CLK_CTRL_ADDR A:0x41900c4
y.create.l HWIO_MSS_UIM0_UART_DM_BCR_ADDR A:0x41900c8
y.create.l HWIO_MSS_UIM0_UART_DM_RX_TRANS_CTRL_ADDR A:0x41900cc
y.create.l HWIO_MSS_UIM0_UART_DM_DMRX_DBG_ADDR A:0x41900d0
y.create.l HWIO_MSS_UIM0_UART_DM_FSM_STATUS_ADDR A:0x41900d4
y.create.l HWIO_MSS_UIM0_UART_DM_HW_VERSION_ADDR A:0x41900d8
y.create.l HWIO_MSS_UIM0_UART_DM_GENERICS_ADDR A:0x41900dc
y.create.l HWIO_MSS_UIM0_UART_DM_TF_ADDR A:0x4190100
y.create.l HWIO_MSS_UIM0_UART_DM_TF_2_ADDR A:0x4190104
y.create.l HWIO_MSS_UIM0_UART_DM_TF_3_ADDR A:0x4190108
y.create.l HWIO_MSS_UIM0_UART_DM_TF_4_ADDR A:0x419010c
y.create.l HWIO_MSS_UIM0_UART_DM_TF_5_ADDR A:0x4190110
y.create.l HWIO_MSS_UIM0_UART_DM_TF_6_ADDR A:0x4190114
y.create.l HWIO_MSS_UIM0_UART_DM_TF_7_ADDR A:0x4190118
y.create.l HWIO_MSS_UIM0_UART_DM_TF_8_ADDR A:0x419011c
y.create.l HWIO_MSS_UIM0_UART_DM_TF_9_ADDR A:0x4190120
y.create.l HWIO_MSS_UIM0_UART_DM_TF_10_ADDR A:0x4190124
y.create.l HWIO_MSS_UIM0_UART_DM_TF_11_ADDR A:0x4190128
y.create.l HWIO_MSS_UIM0_UART_DM_TF_12_ADDR A:0x419012c
y.create.l HWIO_MSS_UIM0_UART_DM_TF_13_ADDR A:0x4190130
y.create.l HWIO_MSS_UIM0_UART_DM_TF_14_ADDR A:0x4190134
y.create.l HWIO_MSS_UIM0_UART_DM_TF_15_ADDR A:0x4190138
y.create.l HWIO_MSS_UIM0_UART_DM_TF_16_ADDR A:0x419013c
y.create.l HWIO_MSS_UIM0_UART_DM_RF_ADDR A:0x4190140
y.create.l HWIO_MSS_UIM0_UART_DM_RF_2_ADDR A:0x4190144
y.create.l HWIO_MSS_UIM0_UART_DM_RF_3_ADDR A:0x4190148
y.create.l HWIO_MSS_UIM0_UART_DM_RF_4_ADDR A:0x419014c
y.create.l HWIO_MSS_UIM0_UART_DM_RF_5_ADDR A:0x4190150
y.create.l HWIO_MSS_UIM0_UART_DM_RF_6_ADDR A:0x4190154
y.create.l HWIO_MSS_UIM0_UART_DM_RF_7_ADDR A:0x4190158
y.create.l HWIO_MSS_UIM0_UART_DM_RF_8_ADDR A:0x419015c
y.create.l HWIO_MSS_UIM0_UART_DM_RF_9_ADDR A:0x4190160
y.create.l HWIO_MSS_UIM0_UART_DM_RF_10_ADDR A:0x4190164
y.create.l HWIO_MSS_UIM0_UART_DM_RF_11_ADDR A:0x4190168
y.create.l HWIO_MSS_UIM0_UART_DM_RF_12_ADDR A:0x419016c
y.create.l HWIO_MSS_UIM0_UART_DM_RF_13_ADDR A:0x4190170
y.create.l HWIO_MSS_UIM0_UART_DM_RF_14_ADDR A:0x4190174
y.create.l HWIO_MSS_UIM0_UART_DM_RF_15_ADDR A:0x4190178
y.create.l HWIO_MSS_UIM0_UART_DM_RF_16_ADDR A:0x419017c
y.create.l HWIO_MSS_UIM0_UART_DM_UIM_CFG_ADDR A:0x4190180
y.create.l HWIO_MSS_UIM0_UART_DM_UIM_CMD_ADDR A:0x4190184
y.create.l HWIO_MSS_UIM0_UART_DM_UIM_IO_STATUS_ADDR A:0x4190188
y.create.l HWIO_MSS_UIM0_UART_DM_UIM_IRQ_ISR_ADDR A:0x419018c
y.create.l HWIO_MSS_UIM0_UART_DM_UIM_IRQ_MISR_ADDR A:0x4190190
y.create.l HWIO_MSS_UIM0_UART_DM_UIM_IRQ_CLR_ADDR A:0x4190194
y.create.l HWIO_MSS_UIM0_UART_DM_UIM_IRQ_IMR_ADDR A:0x4190198
y.create.l HWIO_MSS_UIM0_UART_DM_UIM_IRQ_IMR_SET_ADDR A:0x419019c
y.create.l HWIO_MSS_UIM0_UART_DM_UIM_IRQ_IMR_CLR_ADDR A:0x41901a0
y.create.l HWIO_MSS_UIM1_UART_DM_MR1_ADDR A:0x4198000
y.create.l HWIO_MSS_UIM1_UART_DM_MR2_ADDR A:0x4198004
y.create.l HWIO_MSS_UIM1_UART_DM_CSR_SR_DEPRECATED_ADDR A:0x4198008
y.create.l HWIO_MSS_UIM1_UART_DM_CR_MISR_DEPRECATED_ADDR A:0x4198010
y.create.l HWIO_MSS_UIM1_UART_DM_IMR_ISR_DEPRECATED_ADDR A:0x4198014
y.create.l HWIO_MSS_UIM1_UART_DM_IPR_ADDR A:0x4198018
y.create.l HWIO_MSS_UIM1_UART_DM_TFWR_ADDR A:0x419801c
y.create.l HWIO_MSS_UIM1_UART_DM_RFWR_ADDR A:0x4198020
y.create.l HWIO_MSS_UIM1_UART_DM_HCR_ADDR A:0x4198024
y.create.l HWIO_MSS_UIM1_UART_DM_DMRX_ADDR A:0x4198034
y.create.l HWIO_MSS_UIM1_UART_DM_IRDA_RX_TOTAL_SNAP_DEPRECATED_ADDR A:0x4198038
y.create.l HWIO_MSS_UIM1_UART_DM_DMEN_ADDR A:0x419803c
y.create.l HWIO_MSS_UIM1_UART_DM_NO_CHARS_FOR_TX_ADDR A:0x4198040
y.create.l HWIO_MSS_UIM1_UART_DM_BADR_ADDR A:0x4198044
y.create.l HWIO_MSS_UIM1_UART_DM_TESTSL_ADDR A:0x4198048
y.create.l HWIO_MSS_UIM1_UART_DM_TXFS_ADDR A:0x419804c
y.create.l HWIO_MSS_UIM1_UART_DM_RXFS_ADDR A:0x4198050
y.create.l HWIO_MSS_UIM1_UART_DM_MISR_MODE_ADDR A:0x4198060
y.create.l HWIO_MSS_UIM1_UART_DM_MISR_RESET_ADDR A:0x4198064
y.create.l HWIO_MSS_UIM1_UART_DM_MISR_EXPORT_ADDR A:0x4198068
y.create.l HWIO_MSS_UIM1_UART_DM_MISR_VAL_ADDR A:0x419806c
y.create.l HWIO_MSS_UIM1_UART_DM_TF_RF_DEPRECATED_ADDR A:0x4198070
y.create.l HWIO_MSS_UIM1_UART_DM_TF_RF_2_DEPRECATED_ADDR A:0x4198074
y.create.l HWIO_MSS_UIM1_UART_DM_TF_RF_3_DEPRECATED_ADDR A:0x4198078
y.create.l HWIO_MSS_UIM1_UART_DM_TF_RF_4_DEPRECATED_ADDR A:0x419807c
y.create.l HWIO_MSS_UIM1_UART_DM_SIM_CFG_ADDR A:0x4198080
y.create.l HWIO_MSS_UIM1_UART_DM_TEST_WR_ADDR_ADDR A:0x4198084
y.create.l HWIO_MSS_UIM1_UART_DM_TEST_WR_DATA_ADDR A:0x4198088
y.create.l HWIO_MSS_UIM1_UART_DM_TEST_RD_ADDR_ADDR A:0x419808c
y.create.l HWIO_MSS_UIM1_UART_DM_TEST_RD_DATA_ADDR A:0x4198090
y.create.l HWIO_MSS_UIM1_UART_DM_CSR_ADDR A:0x41980a0
y.create.l HWIO_MSS_UIM1_UART_DM_SR_ADDR A:0x41980a4
y.create.l HWIO_MSS_UIM1_UART_DM_CR_ADDR A:0x41980a8
y.create.l HWIO_MSS_UIM1_UART_DM_MISR_ADDR A:0x41980ac
y.create.l HWIO_MSS_UIM1_UART_DM_IMR_ADDR A:0x41980b0
y.create.l HWIO_MSS_UIM1_UART_DM_ISR_ADDR A:0x41980b4
y.create.l HWIO_MSS_UIM1_UART_DM_IRDA_ADDR A:0x41980b8
y.create.l HWIO_MSS_UIM1_UART_DM_RX_TOTAL_SNAP_ADDR A:0x41980bc
y.create.l HWIO_MSS_UIM1_UART_DM_WWT_TIMEOUT_ADDR A:0x41980c0
y.create.l HWIO_MSS_UIM1_UART_DM_CLK_CTRL_ADDR A:0x41980c4
y.create.l HWIO_MSS_UIM1_UART_DM_BCR_ADDR A:0x41980c8
y.create.l HWIO_MSS_UIM1_UART_DM_RX_TRANS_CTRL_ADDR A:0x41980cc
y.create.l HWIO_MSS_UIM1_UART_DM_DMRX_DBG_ADDR A:0x41980d0
y.create.l HWIO_MSS_UIM1_UART_DM_FSM_STATUS_ADDR A:0x41980d4
y.create.l HWIO_MSS_UIM1_UART_DM_HW_VERSION_ADDR A:0x41980d8
y.create.l HWIO_MSS_UIM1_UART_DM_GENERICS_ADDR A:0x41980dc
y.create.l HWIO_MSS_UIM1_UART_DM_TF_ADDR A:0x4198100
y.create.l HWIO_MSS_UIM1_UART_DM_TF_2_ADDR A:0x4198104
y.create.l HWIO_MSS_UIM1_UART_DM_TF_3_ADDR A:0x4198108
y.create.l HWIO_MSS_UIM1_UART_DM_TF_4_ADDR A:0x419810c
y.create.l HWIO_MSS_UIM1_UART_DM_TF_5_ADDR A:0x4198110
y.create.l HWIO_MSS_UIM1_UART_DM_TF_6_ADDR A:0x4198114
y.create.l HWIO_MSS_UIM1_UART_DM_TF_7_ADDR A:0x4198118
y.create.l HWIO_MSS_UIM1_UART_DM_TF_8_ADDR A:0x419811c
y.create.l HWIO_MSS_UIM1_UART_DM_TF_9_ADDR A:0x4198120
y.create.l HWIO_MSS_UIM1_UART_DM_TF_10_ADDR A:0x4198124
y.create.l HWIO_MSS_UIM1_UART_DM_TF_11_ADDR A:0x4198128
y.create.l HWIO_MSS_UIM1_UART_DM_TF_12_ADDR A:0x419812c
y.create.l HWIO_MSS_UIM1_UART_DM_TF_13_ADDR A:0x4198130
y.create.l HWIO_MSS_UIM1_UART_DM_TF_14_ADDR A:0x4198134
y.create.l HWIO_MSS_UIM1_UART_DM_TF_15_ADDR A:0x4198138
y.create.l HWIO_MSS_UIM1_UART_DM_TF_16_ADDR A:0x419813c
y.create.l HWIO_MSS_UIM1_UART_DM_RF_ADDR A:0x4198140
y.create.l HWIO_MSS_UIM1_UART_DM_RF_2_ADDR A:0x4198144
y.create.l HWIO_MSS_UIM1_UART_DM_RF_3_ADDR A:0x4198148
y.create.l HWIO_MSS_UIM1_UART_DM_RF_4_ADDR A:0x419814c
y.create.l HWIO_MSS_UIM1_UART_DM_RF_5_ADDR A:0x4198150
y.create.l HWIO_MSS_UIM1_UART_DM_RF_6_ADDR A:0x4198154
y.create.l HWIO_MSS_UIM1_UART_DM_RF_7_ADDR A:0x4198158
y.create.l HWIO_MSS_UIM1_UART_DM_RF_8_ADDR A:0x419815c
y.create.l HWIO_MSS_UIM1_UART_DM_RF_9_ADDR A:0x4198160
y.create.l HWIO_MSS_UIM1_UART_DM_RF_10_ADDR A:0x4198164
y.create.l HWIO_MSS_UIM1_UART_DM_RF_11_ADDR A:0x4198168
y.create.l HWIO_MSS_UIM1_UART_DM_RF_12_ADDR A:0x419816c
y.create.l HWIO_MSS_UIM1_UART_DM_RF_13_ADDR A:0x4198170
y.create.l HWIO_MSS_UIM1_UART_DM_RF_14_ADDR A:0x4198174
y.create.l HWIO_MSS_UIM1_UART_DM_RF_15_ADDR A:0x4198178
y.create.l HWIO_MSS_UIM1_UART_DM_RF_16_ADDR A:0x419817c
y.create.l HWIO_MSS_UIM1_UART_DM_UIM_CFG_ADDR A:0x4198180
y.create.l HWIO_MSS_UIM1_UART_DM_UIM_CMD_ADDR A:0x4198184
y.create.l HWIO_MSS_UIM1_UART_DM_UIM_IO_STATUS_ADDR A:0x4198188
y.create.l HWIO_MSS_UIM1_UART_DM_UIM_IRQ_ISR_ADDR A:0x419818c
y.create.l HWIO_MSS_UIM1_UART_DM_UIM_IRQ_MISR_ADDR A:0x4198190
y.create.l HWIO_MSS_UIM1_UART_DM_UIM_IRQ_CLR_ADDR A:0x4198194
y.create.l HWIO_MSS_UIM1_UART_DM_UIM_IRQ_IMR_ADDR A:0x4198198
y.create.l HWIO_MSS_UIM1_UART_DM_UIM_IRQ_IMR_SET_ADDR A:0x419819c
y.create.l HWIO_MSS_UIM1_UART_DM_UIM_IRQ_IMR_CLR_ADDR A:0x41981a0
y.create.l HWIO_MSS_UIM2_UART_DM_MR1_ADDR A:0x41a8000
y.create.l HWIO_MSS_UIM2_UART_DM_MR2_ADDR A:0x41a8004
y.create.l HWIO_MSS_UIM2_UART_DM_CSR_SR_DEPRECATED_ADDR A:0x41a8008
y.create.l HWIO_MSS_UIM2_UART_DM_CR_MISR_DEPRECATED_ADDR A:0x41a8010
y.create.l HWIO_MSS_UIM2_UART_DM_IMR_ISR_DEPRECATED_ADDR A:0x41a8014
y.create.l HWIO_MSS_UIM2_UART_DM_IPR_ADDR A:0x41a8018
y.create.l HWIO_MSS_UIM2_UART_DM_TFWR_ADDR A:0x41a801c
y.create.l HWIO_MSS_UIM2_UART_DM_RFWR_ADDR A:0x41a8020
y.create.l HWIO_MSS_UIM2_UART_DM_HCR_ADDR A:0x41a8024
y.create.l HWIO_MSS_UIM2_UART_DM_DMRX_ADDR A:0x41a8034
y.create.l HWIO_MSS_UIM2_UART_DM_IRDA_RX_TOTAL_SNAP_DEPRECATED_ADDR A:0x41a8038
y.create.l HWIO_MSS_UIM2_UART_DM_DMEN_ADDR A:0x41a803c
y.create.l HWIO_MSS_UIM2_UART_DM_NO_CHARS_FOR_TX_ADDR A:0x41a8040
y.create.l HWIO_MSS_UIM2_UART_DM_BADR_ADDR A:0x41a8044
y.create.l HWIO_MSS_UIM2_UART_DM_TESTSL_ADDR A:0x41a8048
y.create.l HWIO_MSS_UIM2_UART_DM_TXFS_ADDR A:0x41a804c
y.create.l HWIO_MSS_UIM2_UART_DM_RXFS_ADDR A:0x41a8050
y.create.l HWIO_MSS_UIM2_UART_DM_MISR_MODE_ADDR A:0x41a8060
y.create.l HWIO_MSS_UIM2_UART_DM_MISR_RESET_ADDR A:0x41a8064
y.create.l HWIO_MSS_UIM2_UART_DM_MISR_EXPORT_ADDR A:0x41a8068
y.create.l HWIO_MSS_UIM2_UART_DM_MISR_VAL_ADDR A:0x41a806c
y.create.l HWIO_MSS_UIM2_UART_DM_TF_RF_DEPRECATED_ADDR A:0x41a8070
y.create.l HWIO_MSS_UIM2_UART_DM_TF_RF_2_DEPRECATED_ADDR A:0x41a8074
y.create.l HWIO_MSS_UIM2_UART_DM_TF_RF_3_DEPRECATED_ADDR A:0x41a8078
y.create.l HWIO_MSS_UIM2_UART_DM_TF_RF_4_DEPRECATED_ADDR A:0x41a807c
y.create.l HWIO_MSS_UIM2_UART_DM_SIM_CFG_ADDR A:0x41a8080
y.create.l HWIO_MSS_UIM2_UART_DM_TEST_WR_ADDR_ADDR A:0x41a8084
y.create.l HWIO_MSS_UIM2_UART_DM_TEST_WR_DATA_ADDR A:0x41a8088
y.create.l HWIO_MSS_UIM2_UART_DM_TEST_RD_ADDR_ADDR A:0x41a808c
y.create.l HWIO_MSS_UIM2_UART_DM_TEST_RD_DATA_ADDR A:0x41a8090
y.create.l HWIO_MSS_UIM2_UART_DM_CSR_ADDR A:0x41a80a0
y.create.l HWIO_MSS_UIM2_UART_DM_SR_ADDR A:0x41a80a4
y.create.l HWIO_MSS_UIM2_UART_DM_CR_ADDR A:0x41a80a8
y.create.l HWIO_MSS_UIM2_UART_DM_MISR_ADDR A:0x41a80ac
y.create.l HWIO_MSS_UIM2_UART_DM_IMR_ADDR A:0x41a80b0
y.create.l HWIO_MSS_UIM2_UART_DM_ISR_ADDR A:0x41a80b4
y.create.l HWIO_MSS_UIM2_UART_DM_IRDA_ADDR A:0x41a80b8
y.create.l HWIO_MSS_UIM2_UART_DM_RX_TOTAL_SNAP_ADDR A:0x41a80bc
y.create.l HWIO_MSS_UIM2_UART_DM_WWT_TIMEOUT_ADDR A:0x41a80c0
y.create.l HWIO_MSS_UIM2_UART_DM_CLK_CTRL_ADDR A:0x41a80c4
y.create.l HWIO_MSS_UIM2_UART_DM_BCR_ADDR A:0x41a80c8
y.create.l HWIO_MSS_UIM2_UART_DM_RX_TRANS_CTRL_ADDR A:0x41a80cc
y.create.l HWIO_MSS_UIM2_UART_DM_DMRX_DBG_ADDR A:0x41a80d0
y.create.l HWIO_MSS_UIM2_UART_DM_FSM_STATUS_ADDR A:0x41a80d4
y.create.l HWIO_MSS_UIM2_UART_DM_HW_VERSION_ADDR A:0x41a80d8
y.create.l HWIO_MSS_UIM2_UART_DM_GENERICS_ADDR A:0x41a80dc
y.create.l HWIO_MSS_UIM2_UART_DM_TF_ADDR A:0x41a8100
y.create.l HWIO_MSS_UIM2_UART_DM_TF_2_ADDR A:0x41a8104
y.create.l HWIO_MSS_UIM2_UART_DM_TF_3_ADDR A:0x41a8108
y.create.l HWIO_MSS_UIM2_UART_DM_TF_4_ADDR A:0x41a810c
y.create.l HWIO_MSS_UIM2_UART_DM_TF_5_ADDR A:0x41a8110
y.create.l HWIO_MSS_UIM2_UART_DM_TF_6_ADDR A:0x41a8114
y.create.l HWIO_MSS_UIM2_UART_DM_TF_7_ADDR A:0x41a8118
y.create.l HWIO_MSS_UIM2_UART_DM_TF_8_ADDR A:0x41a811c
y.create.l HWIO_MSS_UIM2_UART_DM_TF_9_ADDR A:0x41a8120
y.create.l HWIO_MSS_UIM2_UART_DM_TF_10_ADDR A:0x41a8124
y.create.l HWIO_MSS_UIM2_UART_DM_TF_11_ADDR A:0x41a8128
y.create.l HWIO_MSS_UIM2_UART_DM_TF_12_ADDR A:0x41a812c
y.create.l HWIO_MSS_UIM2_UART_DM_TF_13_ADDR A:0x41a8130
y.create.l HWIO_MSS_UIM2_UART_DM_TF_14_ADDR A:0x41a8134
y.create.l HWIO_MSS_UIM2_UART_DM_TF_15_ADDR A:0x41a8138
y.create.l HWIO_MSS_UIM2_UART_DM_TF_16_ADDR A:0x41a813c
y.create.l HWIO_MSS_UIM2_UART_DM_RF_ADDR A:0x41a8140
y.create.l HWIO_MSS_UIM2_UART_DM_RF_2_ADDR A:0x41a8144
y.create.l HWIO_MSS_UIM2_UART_DM_RF_3_ADDR A:0x41a8148
y.create.l HWIO_MSS_UIM2_UART_DM_RF_4_ADDR A:0x41a814c
y.create.l HWIO_MSS_UIM2_UART_DM_RF_5_ADDR A:0x41a8150
y.create.l HWIO_MSS_UIM2_UART_DM_RF_6_ADDR A:0x41a8154
y.create.l HWIO_MSS_UIM2_UART_DM_RF_7_ADDR A:0x41a8158
y.create.l HWIO_MSS_UIM2_UART_DM_RF_8_ADDR A:0x41a815c
y.create.l HWIO_MSS_UIM2_UART_DM_RF_9_ADDR A:0x41a8160
y.create.l HWIO_MSS_UIM2_UART_DM_RF_10_ADDR A:0x41a8164
y.create.l HWIO_MSS_UIM2_UART_DM_RF_11_ADDR A:0x41a8168
y.create.l HWIO_MSS_UIM2_UART_DM_RF_12_ADDR A:0x41a816c
y.create.l HWIO_MSS_UIM2_UART_DM_RF_13_ADDR A:0x41a8170
y.create.l HWIO_MSS_UIM2_UART_DM_RF_14_ADDR A:0x41a8174
y.create.l HWIO_MSS_UIM2_UART_DM_RF_15_ADDR A:0x41a8178
y.create.l HWIO_MSS_UIM2_UART_DM_RF_16_ADDR A:0x41a817c
y.create.l HWIO_MSS_UIM2_UART_DM_UIM_CFG_ADDR A:0x41a8180
y.create.l HWIO_MSS_UIM2_UART_DM_UIM_CMD_ADDR A:0x41a8184
y.create.l HWIO_MSS_UIM2_UART_DM_UIM_IO_STATUS_ADDR A:0x41a8188
y.create.l HWIO_MSS_UIM2_UART_DM_UIM_IRQ_ISR_ADDR A:0x41a818c
y.create.l HWIO_MSS_UIM2_UART_DM_UIM_IRQ_MISR_ADDR A:0x41a8190
y.create.l HWIO_MSS_UIM2_UART_DM_UIM_IRQ_CLR_ADDR A:0x41a8194
y.create.l HWIO_MSS_UIM2_UART_DM_UIM_IRQ_IMR_ADDR A:0x41a8198
y.create.l HWIO_MSS_UIM2_UART_DM_UIM_IRQ_IMR_SET_ADDR A:0x41a819c
y.create.l HWIO_MSS_UIM2_UART_DM_UIM_IRQ_IMR_CLR_ADDR A:0x41a81a0
y.create.l HWIO_MSS_CONF_ABT_HW_VERSION_ADDR A:0x41b0000
y.create.l HWIO_MSS_CONF_ABT_INST_ID_ADDR A:0x41b0004
y.create.l HWIO_MSS_CONF_ABT_NUM_SLAVES_ADDR A:0x41b0008
y.create.l HWIO_MSS_CONF_ABT_TIMER_LOADVAL_ADDR A:0x41b000c
y.create.l HWIO_MSS_CONF_ABT_TIMER_MODE_ADDR A:0x41b0010
y.create.l HWIO_MSS_CONF_ABT_INTR_STATUS_ADDR A:0x41b0014
y.create.l HWIO_MSS_CONF_ABT_INTR_CLEAR_ADDR A:0x41b0018
y.create.l HWIO_MSS_CONF_ABT_INTR_ENABLE_ADDR A:0x41b001c
y.create.l HWIO_MSS_CONF_ABT_SYND_VALID_ADDR A:0x41b0020
y.create.l HWIO_MSS_CONF_ABT_SYND_CLEAR_ADDR A:0x41b0024
y.create.l HWIO_MSS_CONF_ABT_SYND_ID_ADDR A:0x41b0028
y.create.l HWIO_MSS_CONF_ABT_SYND_ADDR0_ADDR A:0x41b002c
y.create.l HWIO_MSS_CONF_ABT_SYND_ADDR1_ADDR A:0x41b0030
y.create.l HWIO_MSS_CONF_ABT_SYND_HREADY_ADDR A:0x41b0034
y.create.l HWIO_COMBODAC_CFG0_0_ADDR A:0x41b2000
y.create.l HWIO_COMBODAC_CFG1_0_ADDR A:0x41b2008
y.create.l HWIO_COMBODAC_CFG2_0_ADDR A:0x41b2010
y.create.l HWIO_COMBODAC_DIGVAL_EN_0_ADDR A:0x41b2020
y.create.l HWIO_COMBODAC_IREF_CTRL_0_ADDR A:0x41b2028
y.create.l HWIO_COMBODAC_CAL_CTRL_0_ADDR A:0x41b2030
y.create.l HWIO_COMBODAC_CAL_STATUS_0_ADDR A:0x41b2038
y.create.l HWIO_COMBODAC_MEM_RW_CTRL_0_ADDR A:0x41b2040
y.create.l HWIO_COMBODAC_MEM_RD_DATA_0_ADDR A:0x41b2048
y.create.l HWIO_COMBODAC_RTUNE_RW_CTRL_0_ADDR A:0x41b2050
y.create.l HWIO_COMBODAC_RTUNE_RD_DATA_0_ADDR A:0x41b2058
y.create.l HWIO_COMBODAC_DEBUG_INR_0_ADDR A:0x41b2060
y.create.l HWIO_COMBODAC_DEBUG_OUTR_0_ADDR A:0x41b2068
y.create.l HWIO_COMBODAC_DEBUG_ING_0_ADDR A:0x41b2070
y.create.l HWIO_COMBODAC_DEBUG_OUTG_0_ADDR A:0x41b2078
y.create.l HWIO_COMBODAC_TEST_CTRL_0_ADDR A:0x41b2080
y.create.l HWIO_COMBODAC_COMP_CMDS_ADDR A:0x41b2090
y.create.l HWIO_COMBODAC_COMP_STATUS_ADDR A:0x41b2094
y.create.l HWIO_COMBODAC_BIST_CFG_ADDR A:0x41b2098
y.create.l HWIO_COMBODAC_COMP_CTRL_ADDR A:0x41b209c
y.create.l HWIO_COMBODAC0_CLK_CFG_ADDR A:0x41b20a0
y.create.l HWIO_COMBODAC1_CLK_CFG_ADDR A:0x41b20a4
y.create.l HWIO_COMBODAC_CLK_SRC_CFG_ADDR A:0x41b20a8
y.create.l HWIO_COMBODAC_TIME_CYCLE_ADDR A:0x41b20ac
y.create.l HWIO_COMBODAC_FSM_STATE_MONIT_ADDR A:0x41b20b0
y.create.l HWIO_COMBODAC_IREF_STATUS_ADDR A:0x41b20b4
y.create.l HWIO_COMBODAC_REGARRAY0_ADDR A:0x41b2800
y.create.l HWIO_COMBODAC_REGARRAY1_ADDR A:0x41b2804
y.create.l HWIO_COMBODAC_REGARRAY2_ADDR A:0x41b2808
y.create.l HWIO_COMBODAC_REGARRAY3_ADDR A:0x41b280c
y.create.l HWIO_COMBODAC_REGARRAY4_ADDR A:0x41b2810
y.create.l HWIO_COMBODAC_REGARRAY5_ADDR A:0x41b2814
y.create.l HWIO_COMBODAC_REGARRAY6_ADDR A:0x41b2818
y.create.l HWIO_COMBODAC_REGARRAY7_ADDR A:0x41b281c
y.create.l HWIO_COMBODAC_REGARRAY8_ADDR A:0x41b2820
y.create.l HWIO_COMBODAC_REGARRAY9_ADDR A:0x41b2824
y.create.l HWIO_MSS_MGPI_PMIC_CONFIG0_ADDR A:0x41b3000
y.create.l HWIO_MSS_MGPI_PMIC_CONFIG1_ADDR A:0x41b3008
y.create.l HWIO_MSS_MGPI_PMIC_CONFIG2_ADDR A:0x41b3010
y.create.l HWIO_MSS_MGPI_PMIC_CONFIG3_ADDR A:0x41b3018
y.create.l HWIO_MSS_MGPI_PMIC_CONFIG4_ADDR A:0x41b3020
y.create.l HWIO_MSS_MGPI_PMIC_CONFIG5_ADDR A:0x41b3028
y.create.l HWIO_MSS_MGPI_PMIC_CONFIG6_ADDR A:0x41b3030
y.create.l HWIO_MSS_MGPI_PMIC_CONFIG7_ADDR A:0x41b3038
y.create.l HWIO_MSS_MGPI_PMIC_CONFIG8_ADDR A:0x41b3040
y.create.l HWIO_MSS_MGPI_PMIC_CONFIG9_ADDR A:0x41b3048
y.create.l HWIO_MSS_MGPI_CONF_STATUS0_ADDR A:0x41b3004
y.create.l HWIO_MSS_MGPI_CONF_STATUS1_ADDR A:0x41b300c
y.create.l HWIO_MSS_MGPI_CONF_STATUS2_ADDR A:0x41b3014
y.create.l HWIO_MSS_MGPI_CONF_STATUS3_ADDR A:0x41b301c
y.create.l HWIO_MSS_MGPI_CONF_STATUS4_ADDR A:0x41b3024
y.create.l HWIO_MSS_MGPI_CONF_STATUS5_ADDR A:0x41b302c
y.create.l HWIO_MSS_MGPI_CONF_STATUS6_ADDR A:0x41b3034
y.create.l HWIO_MSS_MGPI_CONF_STATUS7_ADDR A:0x41b303c
y.create.l HWIO_MSS_MGPI_CONF_STATUS8_ADDR A:0x41b3044
y.create.l HWIO_MSS_MGPI_CONF_STATUS9_ADDR A:0x41b304c
y.create.l HWIO_MSS_MGPI_MASTER_CSR_ADDR A:0x41b3100
y.create.l HWIO_MSS_MGPI_HW_VERSION_ADDR A:0x41b3104
y.create.l HWIO_MSS_CRYPTO_VERSION_ADDR A:0x41fa000
y.create.l HWIO_MSS_CRYPTO_DATA_IN0_ADDR A:0x41fa010
y.create.l HWIO_MSS_CRYPTO_DATA_IN1_ADDR A:0x41fa014
y.create.l HWIO_MSS_CRYPTO_DATA_IN2_ADDR A:0x41fa018
y.create.l HWIO_MSS_CRYPTO_DATA_IN3_ADDR A:0x41fa01c
y.create.l HWIO_MSS_CRYPTO_DATA_OUT0_ADDR A:0x41fa020
y.create.l HWIO_MSS_CRYPTO_DATA_OUT1_ADDR A:0x41fa024
y.create.l HWIO_MSS_CRYPTO_DATA_OUT2_ADDR A:0x41fa028
y.create.l HWIO_MSS_CRYPTO_DATA_OUT3_ADDR A:0x41fa02c
y.create.l HWIO_MSS_CRYPTO_STATUS_ADDR A:0x41fa100
y.create.l HWIO_MSS_CRYPTO_STATUS2_ADDR A:0x41fa104
y.create.l HWIO_MSS_CRYPTO_ENGINES_AVAIL_ADDR A:0x41fa108
y.create.l HWIO_MSS_CRYPTO_FIFO_SIZES_ADDR A:0x41fa10c
y.create.l HWIO_MSS_CRYPTO_SEG_SIZE_ADDR A:0x41fa110
y.create.l HWIO_MSS_CRYPTO_GOPROC_ADDR A:0x41fa120
y.create.l HWIO_MSS_CRYPTO_GOPROC_QC_KEY_ADDR A:0x41fb000
y.create.l HWIO_MSS_CRYPTO_GOPROC_OEM_KEY_ADDR A:0x41fc000
y.create.l HWIO_MSS_CRYPTO_ENCR_SEG_CFG_ADDR A:0x41fa200
y.create.l HWIO_MSS_CRYPTO_ENCR_SEG_SIZE_ADDR A:0x41fa204
y.create.l HWIO_MSS_CRYPTO_ENCR_SEG_START_ADDR A:0x41fa208
y.create.l HWIO_MSS_CRYPTO_ENCR_KEY0_ADDR A:0x41fd000
y.create.l HWIO_MSS_CRYPTO_ENCR_KEY1_ADDR A:0x41fd004
y.create.l HWIO_MSS_CRYPTO_ENCR_KEY2_ADDR A:0x41fd008
y.create.l HWIO_MSS_CRYPTO_ENCR_KEY3_ADDR A:0x41fd00c
y.create.l HWIO_MSS_CRYPTO_ENCR_KEY4_ADDR A:0x41fd010
y.create.l HWIO_MSS_CRYPTO_ENCR_KEY5_ADDR A:0x41fd014
y.create.l HWIO_MSS_CRYPTO_ENCR_KEY6_ADDR A:0x41fd018
y.create.l HWIO_MSS_CRYPTO_ENCR_KEY7_ADDR A:0x41fd01c
y.create.l HWIO_MSS_CRYPTO_ENCR_XTS_KEY0_ADDR A:0x41fd020
y.create.l HWIO_MSS_CRYPTO_ENCR_XTS_KEY1_ADDR A:0x41fd024
y.create.l HWIO_MSS_CRYPTO_ENCR_XTS_KEY2_ADDR A:0x41fd028
y.create.l HWIO_MSS_CRYPTO_ENCR_XTS_KEY3_ADDR A:0x41fd02c
y.create.l HWIO_MSS_CRYPTO_ENCR_XTS_KEY4_ADDR A:0x41fd030
y.create.l HWIO_MSS_CRYPTO_ENCR_XTS_KEY5_ADDR A:0x41fd034
y.create.l HWIO_MSS_CRYPTO_ENCR_XTS_KEY6_ADDR A:0x41fd038
y.create.l HWIO_MSS_CRYPTO_ENCR_XTS_KEY7_ADDR A:0x41fd03c
y.create.l HWIO_MSS_CRYPTO_ENCR_CNTR0_IV0_ADDR A:0x41fa20c
y.create.l HWIO_MSS_CRYPTO_ENCR_CNTR1_IV1_ADDR A:0x41fa210
y.create.l HWIO_MSS_CRYPTO_ENCR_CNTR2_IV2_ADDR A:0x41fa214
y.create.l HWIO_MSS_CRYPTO_ENCR_CNTR3_IV3_ADDR A:0x41fa218
y.create.l HWIO_MSS_CRYPTO_ENCR_CNTR_MASK_ADDR A:0x41fa21c
y.create.l HWIO_MSS_CRYPTO_ENCR_CNTR_MASK2_ADDR A:0x41fa234
y.create.l HWIO_MSS_CRYPTO_ENCR_CNTR_MASK1_ADDR A:0x41fa238
y.create.l HWIO_MSS_CRYPTO_ENCR_CNTR_MASK0_ADDR A:0x41fa23c
y.create.l HWIO_MSS_CRYPTO_ENCR_CCM_INIT_CNTR0_ADDR A:0x41fa220
y.create.l HWIO_MSS_CRYPTO_ENCR_CCM_INIT_CNTR1_ADDR A:0x41fa224
y.create.l HWIO_MSS_CRYPTO_ENCR_CCM_INIT_CNTR2_ADDR A:0x41fa228
y.create.l HWIO_MSS_CRYPTO_ENCR_CCM_INIT_CNTR3_ADDR A:0x41fa22c
y.create.l HWIO_MSS_CRYPTO_ENCR_XTS_DU_SIZE_ADDR A:0x41fa230
y.create.l HWIO_MSS_CRYPTO_AUTH_SEG_CFG_ADDR A:0x41fa300
y.create.l HWIO_MSS_CRYPTO_AUTH_SEG_SIZE_ADDR A:0x41fa304
y.create.l HWIO_MSS_CRYPTO_AUTH_SEG_START_ADDR A:0x41fa308
y.create.l HWIO_MSS_CRYPTO_AUTH_KEY0_ADDR A:0x41fd040
y.create.l HWIO_MSS_CRYPTO_AUTH_KEY1_ADDR A:0x41fd044
y.create.l HWIO_MSS_CRYPTO_AUTH_KEY2_ADDR A:0x41fd048
y.create.l HWIO_MSS_CRYPTO_AUTH_KEY3_ADDR A:0x41fd04c
y.create.l HWIO_MSS_CRYPTO_AUTH_KEY4_ADDR A:0x41fd050
y.create.l HWIO_MSS_CRYPTO_AUTH_KEY5_ADDR A:0x41fd054
y.create.l HWIO_MSS_CRYPTO_AUTH_KEY6_ADDR A:0x41fd058
y.create.l HWIO_MSS_CRYPTO_AUTH_KEY7_ADDR A:0x41fd05c
y.create.l HWIO_MSS_CRYPTO_AUTH_KEY8_ADDR A:0x41fd060
y.create.l HWIO_MSS_CRYPTO_AUTH_KEY9_ADDR A:0x41fd064
y.create.l HWIO_MSS_CRYPTO_AUTH_IV0_ADDR A:0x41fa310
y.create.l HWIO_MSS_CRYPTO_AUTH_IV1_ADDR A:0x41fa314
y.create.l HWIO_MSS_CRYPTO_AUTH_IV2_ADDR A:0x41fa318
y.create.l HWIO_MSS_CRYPTO_AUTH_IV3_ADDR A:0x41fa31c
y.create.l HWIO_MSS_CRYPTO_AUTH_IV4_ADDR A:0x41fa320
y.create.l HWIO_MSS_CRYPTO_AUTH_IV5_ADDR A:0x41fa324
y.create.l HWIO_MSS_CRYPTO_AUTH_IV6_ADDR A:0x41fa328
y.create.l HWIO_MSS_CRYPTO_AUTH_IV7_ADDR A:0x41fa32c
y.create.l HWIO_MSS_CRYPTO_AUTH_INFO_NONCE0_ADDR A:0x41fa350
y.create.l HWIO_MSS_CRYPTO_AUTH_INFO_NONCE1_ADDR A:0x41fa354
y.create.l HWIO_MSS_CRYPTO_AUTH_INFO_NONCE2_ADDR A:0x41fa358
y.create.l HWIO_MSS_CRYPTO_AUTH_INFO_NONCE3_ADDR A:0x41fa35c
y.create.l HWIO_MSS_CRYPTO_AUTH_BYTECNT0_ADDR A:0x41fa390
y.create.l HWIO_MSS_CRYPTO_AUTH_BYTECNT1_ADDR A:0x41fa394
y.create.l HWIO_MSS_CRYPTO_AUTH_EXP_MAC0_ADDR A:0x41fa3a0
y.create.l HWIO_MSS_CRYPTO_AUTH_EXP_MAC1_ADDR A:0x41fa3a4
y.create.l HWIO_MSS_CRYPTO_AUTH_EXP_MAC2_ADDR A:0x41fa3a8
y.create.l HWIO_MSS_CRYPTO_AUTH_EXP_MAC3_ADDR A:0x41fa3ac
y.create.l HWIO_MSS_CRYPTO_AUTH_EXP_MAC4_ADDR A:0x41fa3b0
y.create.l HWIO_MSS_CRYPTO_AUTH_EXP_MAC5_ADDR A:0x41fa3b4
y.create.l HWIO_MSS_CRYPTO_AUTH_EXP_MAC6_ADDR A:0x41fa3b8
y.create.l HWIO_MSS_CRYPTO_AUTH_EXP_MAC7_ADDR A:0x41fa3bc
y.create.l HWIO_MSS_CRYPTO_CONFIG_ADDR A:0x41fa400
y.create.l HWIO_MSS_CRYPTO_DEBUG_ENABLE_ADDR A:0x41ff000
y.create.l HWIO_MSS_CRYPTO_DEBUG_ADDR A:0x41ff004
y.create.l HWIO_MSS_CRYPTO_PWR_CTRL_ADDR A:0x41ff008
y.create.l HWIO_MSS_CRYPTO_BAM_CTRL_ADDR A:0x41c4000
y.create.l HWIO_MSS_CRYPTO_BAM_TIMER_ADDR A:0x41c4040
y.create.l HWIO_MSS_CRYPTO_BAM_TIMER_CTRL_ADDR A:0x41c4044
y.create.l HWIO_MSS_CRYPTO_BAM_DESC_CNT_TRSHLD_ADDR A:0x41c4008
y.create.l HWIO_MSS_CRYPTO_BAM_IRQ_STTS_ADDR A:0x41c4014
y.create.l HWIO_MSS_CRYPTO_BAM_IRQ_CLR_ADDR A:0x41c4018
y.create.l HWIO_MSS_CRYPTO_BAM_IRQ_EN_ADDR A:0x41c401c
y.create.l HWIO_MSS_CRYPTO_BAM_CNFG_BITS_ADDR A:0x41c407c
y.create.l HWIO_MSS_CRYPTO_BAM_REVISION_ADDR A:0x41c5000
y.create.l HWIO_MSS_CRYPTO_BAM_SW_VERSION_ADDR A:0x41c5004
y.create.l HWIO_MSS_CRYPTO_BAM_NUM_PIPES_ADDR A:0x41c5008
y.create.l HWIO_MSS_CRYPTO_BAM_TEST_BUS_SEL_ADDR A:0x41c5010
y.create.l HWIO_MSS_CRYPTO_BAM_TEST_BUS_REG_ADDR A:0x41c5014
y.create.l HWIO_MSS_CRYPTO_BAM_AHB_MASTER_ERR_CTRLS_ADDR A:0x41c5024
y.create.l HWIO_MSS_CRYPTO_BAM_AHB_MASTER_ERR_ADDR_ADDR A:0x41c5028
y.create.l HWIO_MSS_CRYPTO_BAM_AHB_MASTER_ERR_DATA_ADDR A:0x41c502c
y.create.l HWIO_MSS_CRYPTO_BAM_AHB_MASTER_ERR_ADDR_LSB_ADDR A:0x41c5100
y.create.l HWIO_MSS_CRYPTO_BAM_AHB_MASTER_ERR_ADDR_MSB_ADDR A:0x41c5104
y.create.l HWIO_MSS_CRYPTO_BAM_TRUST_REG_ADDR A:0x41c6000
y.create.l HWIO_MSS_CRYPTO_BAM_P_TRUST_REG0_ADDR A:0x41c6020
y.create.l HWIO_MSS_CRYPTO_BAM_P_TRUST_REG1_ADDR A:0x41c6024
y.create.l HWIO_MSS_CRYPTO_BAM_IRQ_SRCS_EE0_ADDR A:0x41c7000
y.create.l HWIO_MSS_CRYPTO_BAM_IRQ_SRCS_EE1_ADDR A:0x41c8000
y.create.l HWIO_MSS_CRYPTO_BAM_IRQ_SRCS_EE2_ADDR A:0x41c9000
y.create.l HWIO_MSS_CRYPTO_BAM_IRQ_SRCS_EE3_ADDR A:0x41ca000
y.create.l HWIO_MSS_CRYPTO_BAM_IRQ_SRCS_EE4_ADDR A:0x41cb000
y.create.l HWIO_MSS_CRYPTO_BAM_IRQ_SRCS_EE5_ADDR A:0x41cc000
y.create.l HWIO_MSS_CRYPTO_BAM_IRQ_SRCS_EE6_ADDR A:0x41cd000
y.create.l HWIO_MSS_CRYPTO_BAM_IRQ_SRCS_EE7_ADDR A:0x41ce000
y.create.l HWIO_MSS_CRYPTO_BAM_IRQ_SRCS_MSK_EE0_ADDR A:0x41c7004
y.create.l HWIO_MSS_CRYPTO_BAM_IRQ_SRCS_MSK_EE1_ADDR A:0x41c8004
y.create.l HWIO_MSS_CRYPTO_BAM_IRQ_SRCS_MSK_EE2_ADDR A:0x41c9004
y.create.l HWIO_MSS_CRYPTO_BAM_IRQ_SRCS_MSK_EE3_ADDR A:0x41ca004
y.create.l HWIO_MSS_CRYPTO_BAM_IRQ_SRCS_MSK_EE4_ADDR A:0x41cb004
y.create.l HWIO_MSS_CRYPTO_BAM_IRQ_SRCS_MSK_EE5_ADDR A:0x41cc004
y.create.l HWIO_MSS_CRYPTO_BAM_IRQ_SRCS_MSK_EE6_ADDR A:0x41cd004
y.create.l HWIO_MSS_CRYPTO_BAM_IRQ_SRCS_MSK_EE7_ADDR A:0x41ce004
y.create.l HWIO_MSS_CRYPTO_BAM_IRQ_SRCS_UNMASKED_EE0_ADDR A:0x41c7008
y.create.l HWIO_MSS_CRYPTO_BAM_IRQ_SRCS_UNMASKED_EE1_ADDR A:0x41c8008
y.create.l HWIO_MSS_CRYPTO_BAM_IRQ_SRCS_UNMASKED_EE2_ADDR A:0x41c9008
y.create.l HWIO_MSS_CRYPTO_BAM_IRQ_SRCS_UNMASKED_EE3_ADDR A:0x41ca008
y.create.l HWIO_MSS_CRYPTO_BAM_IRQ_SRCS_UNMASKED_EE4_ADDR A:0x41cb008
y.create.l HWIO_MSS_CRYPTO_BAM_IRQ_SRCS_UNMASKED_EE5_ADDR A:0x41cc008
y.create.l HWIO_MSS_CRYPTO_BAM_IRQ_SRCS_UNMASKED_EE6_ADDR A:0x41cd008
y.create.l HWIO_MSS_CRYPTO_BAM_IRQ_SRCS_UNMASKED_EE7_ADDR A:0x41ce008
y.create.l HWIO_MSS_CRYPTO_BAM_PIPE_ATTR_EE0_ADDR A:0x41c700c
y.create.l HWIO_MSS_CRYPTO_BAM_PIPE_ATTR_EE1_ADDR A:0x41c800c
y.create.l HWIO_MSS_CRYPTO_BAM_PIPE_ATTR_EE2_ADDR A:0x41c900c
y.create.l HWIO_MSS_CRYPTO_BAM_PIPE_ATTR_EE3_ADDR A:0x41ca00c
y.create.l HWIO_MSS_CRYPTO_BAM_PIPE_ATTR_EE4_ADDR A:0x41cb00c
y.create.l HWIO_MSS_CRYPTO_BAM_PIPE_ATTR_EE5_ADDR A:0x41cc00c
y.create.l HWIO_MSS_CRYPTO_BAM_PIPE_ATTR_EE6_ADDR A:0x41cd00c
y.create.l HWIO_MSS_CRYPTO_BAM_PIPE_ATTR_EE7_ADDR A:0x41ce00c
y.create.l HWIO_MSS_CRYPTO_BAM_IRQ_SRCS_ADDR A:0x41c7010
y.create.l HWIO_MSS_CRYPTO_BAM_IRQ_SRCS_MSK_ADDR A:0x41c7014
y.create.l HWIO_MSS_CRYPTO_BAM_IRQ_SRCS_UNMASKED_ADDR A:0x41c7018
y.create.l HWIO_MSS_CRYPTO_BAM_P_CTRL0_ADDR A:0x41d7000
y.create.l HWIO_MSS_CRYPTO_BAM_P_CTRL1_ADDR A:0x41d8000
y.create.l HWIO_MSS_CRYPTO_BAM_P_RST0_ADDR A:0x41d7004
y.create.l HWIO_MSS_CRYPTO_BAM_P_RST1_ADDR A:0x41d8004
y.create.l HWIO_MSS_CRYPTO_BAM_P_HALT0_ADDR A:0x41d7008
y.create.l HWIO_MSS_CRYPTO_BAM_P_HALT1_ADDR A:0x41d8008
y.create.l HWIO_MSS_CRYPTO_BAM_P_IRQ_STTS0_ADDR A:0x41d7010
y.create.l HWIO_MSS_CRYPTO_BAM_P_IRQ_STTS1_ADDR A:0x41d8010
y.create.l HWIO_MSS_CRYPTO_BAM_P_IRQ_CLR0_ADDR A:0x41d7014
y.create.l HWIO_MSS_CRYPTO_BAM_P_IRQ_CLR1_ADDR A:0x41d8014
y.create.l HWIO_MSS_CRYPTO_BAM_P_IRQ_EN0_ADDR A:0x41d7018
y.create.l HWIO_MSS_CRYPTO_BAM_P_IRQ_EN1_ADDR A:0x41d8018
y.create.l HWIO_MSS_CRYPTO_BAM_P_TIMER0_ADDR A:0x41d701c
y.create.l HWIO_MSS_CRYPTO_BAM_P_TIMER1_ADDR A:0x41d801c
y.create.l HWIO_MSS_CRYPTO_BAM_P_TIMER_CTRL0_ADDR A:0x41d7020
y.create.l HWIO_MSS_CRYPTO_BAM_P_TIMER_CTRL1_ADDR A:0x41d8020
y.create.l HWIO_MSS_CRYPTO_BAM_P_PRDCR_SDBND0_ADDR A:0x41d7024
y.create.l HWIO_MSS_CRYPTO_BAM_P_PRDCR_SDBND1_ADDR A:0x41d8024
y.create.l HWIO_MSS_CRYPTO_BAM_P_CNSMR_SDBND0_ADDR A:0x41d7028
y.create.l HWIO_MSS_CRYPTO_BAM_P_CNSMR_SDBND1_ADDR A:0x41d8028
y.create.l HWIO_MSS_CRYPTO_BAM_P_SW_OFSTS0_ADDR A:0x41d7800
y.create.l HWIO_MSS_CRYPTO_BAM_P_SW_OFSTS1_ADDR A:0x41d8800
y.create.l HWIO_MSS_CRYPTO_BAM_P_AU_PSM_CNTXT_1_0_ADDR A:0x41d7804
y.create.l HWIO_MSS_CRYPTO_BAM_P_AU_PSM_CNTXT_1_1_ADDR A:0x41d8804
y.create.l HWIO_MSS_CRYPTO_BAM_P_PSM_CNTXT_2_0_ADDR A:0x41d7808
y.create.l HWIO_MSS_CRYPTO_BAM_P_PSM_CNTXT_2_1_ADDR A:0x41d8808
y.create.l HWIO_MSS_CRYPTO_BAM_P_PSM_CNTXT_3_0_ADDR A:0x41d780c
y.create.l HWIO_MSS_CRYPTO_BAM_P_PSM_CNTXT_3_1_ADDR A:0x41d880c
y.create.l HWIO_MSS_CRYPTO_BAM_P_PSM_CNTXT_4_0_ADDR A:0x41d7810
y.create.l HWIO_MSS_CRYPTO_BAM_P_PSM_CNTXT_4_1_ADDR A:0x41d8810
y.create.l HWIO_MSS_CRYPTO_BAM_P_PSM_CNTXT_5_0_ADDR A:0x41d7814
y.create.l HWIO_MSS_CRYPTO_BAM_P_PSM_CNTXT_5_1_ADDR A:0x41d8814
y.create.l HWIO_MSS_CRYPTO_BAM_P_EVNT_REG0_ADDR A:0x41d7818
y.create.l HWIO_MSS_CRYPTO_BAM_P_EVNT_REG1_ADDR A:0x41d8818
y.create.l HWIO_MSS_CRYPTO_BAM_P_DESC_FIFO_ADDR0_ADDR A:0x41d781c
y.create.l HWIO_MSS_CRYPTO_BAM_P_DESC_FIFO_ADDR1_ADDR A:0x41d881c
y.create.l HWIO_MSS_CRYPTO_BAM_P_FIFO_SIZES0_ADDR A:0x41d7820
y.create.l HWIO_MSS_CRYPTO_BAM_P_FIFO_SIZES1_ADDR A:0x41d8820
y.create.l HWIO_MSS_CRYPTO_BAM_P_DATA_FIFO_ADDR0_ADDR A:0x41d7824
y.create.l HWIO_MSS_CRYPTO_BAM_P_DATA_FIFO_ADDR1_ADDR A:0x41d8824
y.create.l HWIO_MSS_CRYPTO_BAM_P_EVNT_GEN_TRSHLD0_ADDR A:0x41d7828
y.create.l HWIO_MSS_CRYPTO_BAM_P_EVNT_GEN_TRSHLD1_ADDR A:0x41d8828
y.create.l HWIO_MSS_CRYPTO_BAM_P_EVNT_DEST_ADDR0_ADDR A:0x41d782c
y.create.l HWIO_MSS_CRYPTO_BAM_P_EVNT_DEST_ADDR1_ADDR A:0x41d882c
y.create.l HWIO_MSS_CRYPTO_BAM_P_DF_CNTXT_0_ADDR A:0x41d7830
y.create.l HWIO_MSS_CRYPTO_BAM_P_DF_CNTXT_1_ADDR A:0x41d8830
y.create.l HWIO_MSS_CRYPTO_BAM_P_RETR_CNTXT_0_ADDR A:0x41d7834
y.create.l HWIO_MSS_CRYPTO_BAM_P_RETR_CNTXT_1_ADDR A:0x41d8834
y.create.l HWIO_MSS_CRYPTO_BAM_P_SI_CNTXT_0_ADDR A:0x41d7838
y.create.l HWIO_MSS_CRYPTO_BAM_P_SI_CNTXT_1_ADDR A:0x41d8838
y.create.l HWIO_MSS_CRYPTO_BAM_P_PSM_CNTXT_3_LSB0_ADDR A:0x41d7900
y.create.l HWIO_MSS_CRYPTO_BAM_P_PSM_CNTXT_3_LSB1_ADDR A:0x41d8900
y.create.l HWIO_MSS_CRYPTO_BAM_P_PSM_CNTXT_3_MSB0_ADDR A:0x41d7904
y.create.l HWIO_MSS_CRYPTO_BAM_P_PSM_CNTXT_3_MSB1_ADDR A:0x41d8904
y.create.l HWIO_MSS_CRYPTO_BAM_P_DESC_FIFO_ADDR_LSB0_ADDR A:0x41d7910
y.create.l HWIO_MSS_CRYPTO_BAM_P_DESC_FIFO_ADDR_LSB1_ADDR A:0x41d8910
y.create.l HWIO_MSS_CRYPTO_BAM_P_DESC_FIFO_ADDR_MSB0_ADDR A:0x41d7914
y.create.l HWIO_MSS_CRYPTO_BAM_P_DESC_FIFO_ADDR_MSB1_ADDR A:0x41d8914
y.create.l HWIO_MSS_CRYPTO_BAM_P_DATA_FIFO_ADDR_LSB0_ADDR A:0x41d7920
y.create.l HWIO_MSS_CRYPTO_BAM_P_DATA_FIFO_ADDR_LSB1_ADDR A:0x41d8920
y.create.l HWIO_MSS_CRYPTO_BAM_P_DATA_FIFO_ADDR_MSB0_ADDR A:0x41d7924
y.create.l HWIO_MSS_CRYPTO_BAM_P_DATA_FIFO_ADDR_MSB1_ADDR A:0x41d8924
y.create.l HWIO_MSS_CRYPTO_BAM_P_EVNT_DEST_ADDR_LSB0_ADDR A:0x41d7930
y.create.l HWIO_MSS_CRYPTO_BAM_P_EVNT_DEST_ADDR_LSB1_ADDR A:0x41d8930
y.create.l HWIO_MSS_CRYPTO_BAM_P_EVNT_DEST_ADDR_MSB0_ADDR A:0x41d7934
y.create.l HWIO_MSS_CRYPTO_BAM_P_EVNT_DEST_ADDR_MSB1_ADDR A:0x41d8934
y.create.l HWIO_MSS_RC_CONTROL_ADDR A:0x4200000
y.create.l HWIO_MSS_RC_CONFIG_ADDR A:0x4200004
y.create.l HWIO_MSS_RC_LPM_RTC_CONTROL_ADDR A:0x4200008
y.create.l HWIO_MSS_RC_PPSO_ASSERT_ADDR A:0x420000c
y.create.l HWIO_MSS_RC_PPSO_DEASSERT_ADDR A:0x4200010
y.create.l HWIO_MSS_RC_GPS_ON_ADDR A:0x4200014
y.create.l HWIO_MSS_RC_TIME_TRANSFER_ADDR A:0x4200018
y.create.l HWIO_MSS_RC_GNSS_RTC_STATUS_ADDR A:0x420001c
y.create.l HWIO_MSS_RC_BP1_COUNT_STATUS_ADDR A:0x4200020
y.create.l HWIO_MSS_RC_BP1_PHASE_STATUS_ADDR A:0x4200024
y.create.l HWIO_MSS_RC_BP2_COUNT_STATUS_ADDR A:0x4200028
y.create.l HWIO_MSS_RC_BP2_PHASE_STATUS_ADDR A:0x420002c
y.create.l HWIO_MSS_RC_BP3_COUNT_STATUS_ADDR A:0x4200030
y.create.l HWIO_MSS_RC_BP3_PHASE_STATUS_ADDR A:0x4200034
y.create.l HWIO_MSS_RC_BP4_COUNT_STATUS_ADDR A:0x4200038
y.create.l HWIO_MSS_RC_BP4_PHASE_STATUS_ADDR A:0x420003c
y.create.l HWIO_MSS_RC_TT_STATUS_ADDR A:0x4200040
y.create.l HWIO_MSS_RC_IRQ_STATUS_ADDR A:0x4200044
y.create.l HWIO_MSS_RC_PPSI_RTC_ADDR A:0x4200048
y.create.l HWIO_MSS_RC_NAV_TT_RTC_ADDR A:0x420004c
y.create.l HWIO_MSS_RC_CDMA_TT_RTC_ADDR A:0x4200050
y.create.l HWIO_MSS_RC_GNSS_TT_CNT_ADDR A:0x4200054
y.create.l HWIO_MSS_RC_NAV_TEST_BUS_ADDR A:0x4200058
y.create.l HWIO_MSS_RC_B1_POLYNOMIAL_MASK_ADDR A:0x420005c
y.create.l HWIO_MSS_AD_MODE_ADDR A:0x4200080
y.create.l HWIO_MSS_AD_RX1_CONFIG_ADDR A:0x4200084
y.create.l HWIO_MSS_AD_RX2_CONFIG_ADDR A:0x4200088
y.create.l HWIO_MSS_AD_RX1_QUANTMAP_ADDR A:0x420008c
y.create.l HWIO_MSS_AD_RX2_QUANTMAP_ADDR A:0x4200090
y.create.l HWIO_MSS_AD_MEAS_STATUS_ADDR A:0x4200094
y.create.l HWIO_MSS_AD_RX1_MEAN_MON_ADDR A:0x4200098
y.create.l HWIO_MSS_AD_RX2_MEAN_MON_ADDR A:0x420009c
y.create.l HWIO_MSS_AD_RX1_BLANK_MONITOR_ADDR A:0x42000a0
y.create.l HWIO_MSS_AD_RX2_BLANK_MONITOR_ADDR A:0x42000a4
y.create.l HWIO_MSS_AD_SL_INDEX_ADDR A:0x42000a8
y.create.l HWIO_MSS_AD_RX1_AMPL_MON_ADDR A:0x42000ac
y.create.l HWIO_MSS_AD_RX2_AMPL_MON_ADDR A:0x42000b0
y.create.l HWIO_MSS_AD_SPEC_ANALYZER_CMD_ADDR A:0x42000b4
y.create.l HWIO_MSS_AD_SPEC_ANALYZER_STATUS_ADDR A:0x42000b8
y.create.l HWIO_MSS_BP1_CONFIG_ADDR A:0x4200200
y.create.l HWIO_MSS_BP1_IF_FREQ_ADDR A:0x4200204
y.create.l HWIO_MSS_BP1_RS_RATE_ADDR A:0x4200208
y.create.l HWIO_MSS_BP1_OFFSET_ADDR A:0x420020c
y.create.l HWIO_MSS_BP1_NOTCH1_ADDR A:0x4200210
y.create.l HWIO_MSS_BP1_NOTCH2_ADDR A:0x4200214
y.create.l HWIO_MSS_BP1_NOTCH3_ADDR A:0x4200218
y.create.l HWIO_MSS_BP1_NOTCH4_ADDR A:0x420021c
y.create.l HWIO_MSS_BP1_NOTCH5_ADDR A:0x4200220
y.create.l HWIO_MSS_BP1_NOTCH6_ADDR A:0x4200224
y.create.l HWIO_MSS_BP1_EQ_COEF_REAL_ADDR A:0x4200228
y.create.l HWIO_MSS_BP1_EQ_COEF_IMAG_ADDR A:0x420022c
y.create.l HWIO_MSS_BP1_FREQ_ADDR A:0x4200230
y.create.l HWIO_MSS_BP1_THRESH_ADDR A:0x4200234
y.create.l HWIO_MSS_BP1_PRE_NOTCH_ADDR A:0x4200238
y.create.l HWIO_MSS_BP1_RS_PHASE_ADDR A:0x420023c
y.create.l HWIO_MSS_BP1_PRE_AMPL_MON_ADDR A:0x4200240
y.create.l HWIO_MSS_BP1_MEAN_MON_ADDR A:0x4200244
y.create.l HWIO_MSS_BP1_SCH2_AMPL_MON_ADDR A:0x4200248
y.create.l HWIO_MSS_BP1_SCH3_AMPL_MON_ADDR A:0x420024c
y.create.l HWIO_MSS_BP2_CONFIG_ADDR A:0x4200300
y.create.l HWIO_MSS_BP2_IF_FREQ_ADDR A:0x4200304
y.create.l HWIO_MSS_BP2_RS_RATE_ADDR A:0x4200308
y.create.l HWIO_MSS_BP2_OFFSET_ADDR A:0x420030c
y.create.l HWIO_MSS_BP2_NOTCH1_ADDR A:0x4200310
y.create.l HWIO_MSS_BP2_NOTCH2_ADDR A:0x4200314
y.create.l HWIO_MSS_BP2_NOTCH3_ADDR A:0x4200318
y.create.l HWIO_MSS_BP2_NOTCH4_ADDR A:0x420031c
y.create.l HWIO_MSS_BP2_NOTCH5_ADDR A:0x4200320
y.create.l HWIO_MSS_BP2_NOTCH6_ADDR A:0x4200324
y.create.l HWIO_MSS_BP2_EQ_COEF_REAL_ADDR A:0x4200328
y.create.l HWIO_MSS_BP2_EQ_COEF_IMAG_ADDR A:0x420032c
y.create.l HWIO_MSS_BP2_FREQ_ADDR A:0x4200330
y.create.l HWIO_MSS_BP2_THRESH_ADDR A:0x4200334
y.create.l HWIO_MSS_BP2_PRE_NOTCH_ADDR A:0x4200338
y.create.l HWIO_MSS_BP2_RS_PHASE_ADDR A:0x420033c
y.create.l HWIO_MSS_BP2_PRE_AMPL_MON_ADDR A:0x4200340
y.create.l HWIO_MSS_BP2_MEAN_MON_ADDR A:0x4200344
y.create.l HWIO_MSS_BP2_SCH2_AMPL_MON_ADDR A:0x4200348
y.create.l HWIO_MSS_BP2_SCH3_AMPL_MON_ADDR A:0x420034c
y.create.l HWIO_MSS_BP3_CONFIG_ADDR A:0x4200400
y.create.l HWIO_MSS_BP3_IF_FREQ_ADDR A:0x4200404
y.create.l HWIO_MSS_BP3_RS_RATE_ADDR A:0x4200408
y.create.l HWIO_MSS_BP3_OFFSET_ADDR A:0x420040c
y.create.l HWIO_MSS_BP3_NOTCH1_ADDR A:0x4200410
y.create.l HWIO_MSS_BP3_NOTCH2_ADDR A:0x4200414
y.create.l HWIO_MSS_BP3_NOTCH3_ADDR A:0x4200418
y.create.l HWIO_MSS_BP3_NOTCH4_ADDR A:0x420041c
y.create.l HWIO_MSS_BP3_NOTCH5_ADDR A:0x4200420
y.create.l HWIO_MSS_BP3_NOTCH6_ADDR A:0x4200424
y.create.l HWIO_MSS_BP3_EQ_COEF_REAL_ADDR A:0x4200428
y.create.l HWIO_MSS_BP3_EQ_COEF_IMAG_ADDR A:0x420042c
y.create.l HWIO_MSS_BP3_RS_PHASE_ADDR A:0x4200430
y.create.l HWIO_MSS_BP3_SCH1_FREQ_ADDR A:0x4200434
y.create.l HWIO_MSS_BP3_SCH2_FREQ_ADDR A:0x4200438
y.create.l HWIO_MSS_BP3_SCH3_FREQ_ADDR A:0x420043c
y.create.l HWIO_MSS_BP3_SCH4_FREQ_ADDR A:0x4200440
y.create.l HWIO_MSS_BP3_SCH5_FREQ_ADDR A:0x4200444
y.create.l HWIO_MSS_BP3_SCH6_FREQ_ADDR A:0x4200448
y.create.l HWIO_MSS_BP3_SCH7_FREQ_ADDR A:0x420044c
y.create.l HWIO_MSS_BP3_SCH8_FREQ_ADDR A:0x4200450
y.create.l HWIO_MSS_BP3_SCH9_FREQ_ADDR A:0x4200454
y.create.l HWIO_MSS_BP3_SCH10_FREQ_ADDR A:0x4200458
y.create.l HWIO_MSS_BP3_SCH11_FREQ_ADDR A:0x420045c
y.create.l HWIO_MSS_BP3_SCH12_FREQ_ADDR A:0x4200460
y.create.l HWIO_MSS_BP3_THRESH_A_ADDR A:0x4200464
y.create.l HWIO_MSS_BP3_THRESH_B_ADDR A:0x4200468
y.create.l HWIO_MSS_BP3_THRESH_C_ADDR A:0x420046c
y.create.l HWIO_MSS_BP3_THRESH_D_ADDR A:0x4200470
y.create.l HWIO_MSS_BP3_THRESH_E_ADDR A:0x4200474
y.create.l HWIO_MSS_BP3_THRESH_F_ADDR A:0x4200478
y.create.l HWIO_MSS_BP3_PRE_AMPL_MON_ADDR A:0x420047c
y.create.l HWIO_MSS_BP3_MEAN_MON_ADDR A:0x4200480
y.create.l HWIO_MSS_BP3_SCH1_AMPL_MON_ADDR A:0x4200484
y.create.l HWIO_MSS_BP3_SCH2_AMPL_MON_ADDR A:0x4200488
y.create.l HWIO_MSS_BP3_SCH3_AMPL_MON_ADDR A:0x420048c
y.create.l HWIO_MSS_BP3_SCH4_AMPL_MON_ADDR A:0x4200490
y.create.l HWIO_MSS_BP3_SCH5_AMPL_MON_ADDR A:0x4200494
y.create.l HWIO_MSS_BP3_SCH6_AMPL_MON_ADDR A:0x4200498
y.create.l HWIO_MSS_BP3_SCH7_AMPL_MON_ADDR A:0x420049c
y.create.l HWIO_MSS_BP3_SCH8_AMPL_MON_ADDR A:0x42004a0
y.create.l HWIO_MSS_BP3_SCH9_AMPL_MON_ADDR A:0x42004a4
y.create.l HWIO_MSS_BP3_SCH10_AMPL_MON_ADDR A:0x42004a8
y.create.l HWIO_MSS_BP3_SCH11_AMPL_MON_ADDR A:0x42004ac
y.create.l HWIO_MSS_BP3_SCH12_AMPL_MON_ADDR A:0x42004b0
y.create.l HWIO_MSS_BP3_SCH_MODE_ADDR A:0x42004b4
y.create.l HWIO_MSS_BP3_PRE_NOTCH_ADDR A:0x42004b8
y.create.l HWIO_MSS_BP3_NOTCH7_ADDR A:0x42004bc
y.create.l HWIO_MSS_BP3_NOTCH8_ADDR A:0x42004c0
y.create.l HWIO_MSS_BP3_NOTCH9_ADDR A:0x42004c4
y.create.l HWIO_MSS_BP3_NOTCH10_ADDR A:0x42004c8
y.create.l HWIO_MSS_BP3_NOTCH11_ADDR A:0x42004cc
y.create.l HWIO_MSS_BP3_NOTCH12_ADDR A:0x42004d0
y.create.l HWIO_MSS_BP4_CONFIG_ADDR A:0x4200500
y.create.l HWIO_MSS_BP4_IF_FREQ_ADDR A:0x4200504
y.create.l HWIO_MSS_BP4_RS_RATE_ADDR A:0x4200508
y.create.l HWIO_MSS_BP4_OFFSET_ADDR A:0x420050c
y.create.l HWIO_MSS_BP4_NOTCH1_ADDR A:0x4200510
y.create.l HWIO_MSS_BP4_NOTCH2_ADDR A:0x4200514
y.create.l HWIO_MSS_BP4_NOTCH3_ADDR A:0x4200518
y.create.l HWIO_MSS_BP4_NOTCH4_ADDR A:0x420051c
y.create.l HWIO_MSS_BP4_NOTCH5_ADDR A:0x4200520
y.create.l HWIO_MSS_BP4_NOTCH6_ADDR A:0x4200524
y.create.l HWIO_MSS_BP4_EQ_COEF_REAL_ADDR A:0x4200528
y.create.l HWIO_MSS_BP4_EQ_COEF_IMAG_ADDR A:0x420052c
y.create.l HWIO_MSS_BP4_FREQ_ADDR A:0x4200530
y.create.l HWIO_MSS_BP4_THRESH_ADDR A:0x4200534
y.create.l HWIO_MSS_BP4_RS_PHASE_ADDR A:0x4200538
y.create.l HWIO_MSS_BP4_PRE_AMPL_MON_ADDR A:0x420053c
y.create.l HWIO_MSS_BP4_MEAN_MON_ADDR A:0x4200540
y.create.l HWIO_MSS_BP4_AMPL_MON_ADDR A:0x4200544
y.create.l HWIO_MSS_BP4_PRE_NOTCH_ADDR A:0x4200548
y.create.l HWIO_MSS_LTE1_CONFIG_ADDR A:0x42002e0
y.create.l HWIO_MSS_LTE1_IF_FREQ_ADDR A:0x42002e4
y.create.l HWIO_MSS_LTE3_CONFIG_ADDR A:0x42004e0
y.create.l HWIO_MSS_LTE3_IF_FREQ_ADDR A:0x42004e4
y.create.l HWIO_MSS_TSG_CMD0_ADDR A:0x4200100
y.create.l HWIO_MSS_TSG_CH1_CONFIG_ADDR A:0x4200104
y.create.l HWIO_MSS_TSG_CH1_RS_RATE_ADDR A:0x4200108
y.create.l HWIO_MSS_TSG_CH1_INIT_COUNT_ADDR A:0x420010c
y.create.l HWIO_MSS_TSG_CH1_FREQ_ADDR A:0x4200110
y.create.l HWIO_MSS_TSG_CH1_DATA_SEED_ADDR A:0x4200114
y.create.l HWIO_MSS_TSG_CH1_PILOT_SEED_ADDR A:0x4200118
y.create.l HWIO_MSS_TSG_CH2_CONFIG_ADDR A:0x420011c
y.create.l HWIO_MSS_TSG_CH2_RS_RATE_ADDR A:0x4200120
y.create.l HWIO_MSS_TSG_CH2_INIT_COUNT_ADDR A:0x4200124
y.create.l HWIO_MSS_TSG_CH2_FREQ_ADDR A:0x4200128
y.create.l HWIO_MSS_TSG_CH2_DATA_SEED_ADDR A:0x420012c
y.create.l HWIO_MSS_TSG_CH2_PILOT_SEED_ADDR A:0x4200130
y.create.l HWIO_MSS_TSG_RX1_CONFIG_ADDR A:0x4200134
y.create.l HWIO_MSS_TSG_RX1_OFFSET_ADDR A:0x4200138
y.create.l HWIO_MSS_TSG_RX2_CONFIG_ADDR A:0x420013c
y.create.l HWIO_MSS_TSG_RX2_OFFSET_ADDR A:0x4200140
y.create.l HWIO_MSS_TSG_FIRST_CODE_ADDR A:0x4200144
y.create.l HWIO_MSS_TSG_CH1_COUNT_STATUS_ADDR A:0x4200148
y.create.l HWIO_MSS_TSG_CH2_COUNT_STATUS_ADDR A:0x420014c
y.create.l HWIO_MSS_SMI_MODE_ADDR A:0x4200600
y.create.l HWIO_MSS_SMI_BASEADDR1_ADDR A:0x4200604
y.create.l HWIO_MSS_SMI_BASEADDR2_ADDR A:0x4200608
y.create.l HWIO_MSS_SMI_BASEADDR3A_ADDR A:0x420060c
y.create.l HWIO_MSS_SMI_BASEADDR3B_ADDR A:0x4200610
y.create.l HWIO_MSS_SMI_BASEADDR3C_ADDR A:0x4200614
y.create.l HWIO_MSS_SMI_BASEADDR4_ADDR A:0x4200618
y.create.l HWIO_MSS_CP_START_ADDR A:0x4200700
y.create.l HWIO_MSS_CP_CONFIG1_ADDR A:0x4200704
y.create.l HWIO_MSS_CP_CONFIG2_ADDR A:0x4200708
y.create.l HWIO_MSS_CP_SAMPLE_INDEX_ADDR A:0x420070c
y.create.l HWIO_MSS_CP_PHASE_ADDR A:0x4200710
y.create.l HWIO_MSS_CP_FREQ_ADDR A:0x4200714
y.create.l HWIO_MSS_CP_DATA_SEED_ADDR A:0x4200718
y.create.l HWIO_MSS_CP_PILOT_SEED_ADDR A:0x420071c
y.create.l HWIO_MSS_CP_CODE_INDEX_ADDR A:0x4200720
y.create.l HWIO_MSS_CP_COEF1_ADDR A:0x4200724
y.create.l HWIO_MSS_CP_COEF2_ADDR A:0x4200728
y.create.l HWIO_MSS_CP_COEF3_ADDR A:0x420072c
y.create.l HWIO_MSS_CP_COEF4_ADDR A:0x4200730
y.create.l HWIO_MSS_CP_COEF5_ADDR A:0x4200734
y.create.l HWIO_MSS_CP_COEF6_ADDR A:0x4200738
y.create.l HWIO_MSS_CP_STATUS_ADDR A:0x420073c
y.create.l HWIO_MSS_CCP_BREAKPOINT_ADDR A:0x4200800
y.create.l HWIO_MSS_CCP_BREAK_STATE_ADDR A:0x4200804
y.create.l HWIO_MSS_CCP_PROG_STATUS_ADDR A:0x4200808
y.create.l HWIO_MSS_CCP_G10_STATUS_ADDR A:0x420080c
y.create.l HWIO_MSS_CCP_G32_STATUS_ADDR A:0x4200810
y.create.l HWIO_MSS_CCP_G54_STATUS_ADDR A:0x4200814
y.create.l HWIO_MSS_CCP_G76_STATUS_ADDR A:0x4200818
y.create.l HWIO_MSS_CCP_P10_STATUS_ADDR A:0x420081c
y.create.l HWIO_MSS_CCP_P2_STATUS_ADDR A:0x4200820
y.create.l HWIO_MSS_SM_ADDR_BEGIN_ADDR A:0x4240000
y.create.l HWIO_MSS_SM_ADDR_END_ADDR A:0x424effc
y.create.l HWIO_MSS_GPM_ADDR_BEGIN_ADDR A:0x4204000
y.create.l HWIO_MSS_GPM_ADDR_END_ADDR A:0x42047fc
y.create.l HWIO_MSS_GDM_ADDR_BEGIN_ADDR A:0x4208000
y.create.l HWIO_MSS_GDM_ADDR_END_ADDR A:0x42087fc
y.create.l HWIO_MSS_CMA_ADDR_BEGIN_ADDR A:0x420c000
y.create.l HWIO_MSS_CMA_ADDR_END_ADDR A:0x420edfc
y.create.l HWIO_MSS_CMB_ADDR_BEGIN_ADDR A:0x4210000
y.create.l HWIO_MSS_CMB_ADDR_END_ADDR A:0x4212dfc
y.create.l HWIO_MSS_VM_ADDR_BEGIN_ADDR A:0x4218000
y.create.l HWIO_MSS_VM_ADDR_END_ADDR A:0x4218ffc
y.create.l HWIO_MSS_PM_ADDR_BEGIN_ADDR A:0x421c000
y.create.l HWIO_MSS_PM_ADDR_END_ADDR A:0x421cffc
y.create.l HWIO_MSS_CCM_START_CMD_ADDR A:0x4214000
y.create.l HWIO_MSS_CCM_WORD1_CMD_ADDR A:0x4214004
y.create.l HWIO_MSS_CCM_WORD2_CMD_ADDR A:0x4214008
y.create.l HWIO_MSS_CCM_WORD3_CMD_ADDR A:0x421400c
y.create.l HWIO_MSS_CCM_WORD4_CMD_ADDR A:0x4214010
y.create.l HWIO_MSS_CCM_WORD5_CMD_ADDR A:0x4214014
y.create.l HWIO_MSS_CCM_WORD6_CMD_ADDR A:0x4214018
y.create.l HWIO_MSS_CCM_WORD7_CMD_ADDR A:0x421401c
y.create.l HWIO_MSS_CCM_END_CMD_ADDR A:0x4214020
y.create.l HWIO_MSS_CCM_STOP_CMD_ADDR A:0x42147dc
y.create.l HWIO_MSS_CCM_LOAD_CMD_ADDR A:0x42147e0
y.create.l HWIO_MSS_CCM_ERROR_CLEAR_CMD_ADDR A:0x42147e4
y.create.l HWIO_MSS_CCM_TIME_MARGIN_CMD_ADDR A:0x42147e8
y.create.l HWIO_MSS_CCM_LATE_TASK_ERROR_STATUS_ADDR A:0x42147ec
y.create.l HWIO_MSS_CCM_OVERRUN_ERROR_STATUS_ADDR A:0x42147f0
y.create.l HWIO_MSS_CCM_SEQ_NUMBER_STATUS_ADDR A:0x42147f4
y.create.l HWIO_MSS_CCM_DONE_RTC_STATUS_ADDR A:0x42147f8
y.create.l HWIO_MSS_CCM_STALL_COUNT_STATUS_ADDR A:0x42147fc
y.create.l HWIO_MSS_TPM_ADDR_BEGIN_ADDR A:0x4220000
y.create.l HWIO_MSS_TPM_ADDR_END_ADDR A:0x42201fc
y.create.l HWIO_MSS_TDM_ADDR_BEGIN_ADDR A:0x4224000
y.create.l HWIO_MSS_TDM_ADDR_END_ADDR A:0x42241fc
y.create.l HWIO_MSS_GACC_CLK_CTL_ADDR A:0x4200a00
y.create.l HWIO_MSS_GACC_RTC_WAIT_ADDR A:0x4200a04
y.create.l HWIO_MSS_GACC_START_ADDR_ADDR A:0x4200a08
y.create.l HWIO_MSS_GACC_COUNT_ADDR A:0x4200a0c
y.create.l HWIO_MSS_GACC_INCR_ADDR A:0x4200a10
y.create.l HWIO_MSS_GACC_FREQ_ADDR A:0x4200a14
y.create.l HWIO_MSS_GACC_CONFIG_ADDR A:0x4200a18
y.create.l HWIO_MSS_GACC_PEAK_ADDR A:0x4200a1c
y.create.l HWIO_MSS_GACC_DONE_ADDR A:0x4200a20
y.create.l HWIO_MSS_GACC_RTC_ADDR A:0x4200a24
y.create.l HWIO_MSS_GACC_TEST_BUS_OUT_ADDR A:0x4200a28
y.create.l HWIO_MSS_GACC_SAMPLE_MEM_START_ADDR_ADDR A:0x4228000
y.create.l HWIO_MSS_GACC_SAMPLE_MEM_END_ADDR_ADDR A:0x42289fc
y.create.l HWIO_MSS_GACC_ENERGY_MEM_START_ADDR_ADDR A:0x422c000
y.create.l HWIO_MSS_GACC_ENERGY_MEM_END_ADDR_ADDR A:0x422c9fc
y.create.l HWIO_MSS_HI0_CH0_CMD_PTR_SD0_ADDR A:0x4200b00
y.create.l HWIO_MSS_HI0_CH0_CMD_PTR_SD1_ADDR A:0x4200f00
y.create.l HWIO_MSS_HI0_CH0_CMD_PTR_SD2_ADDR A:0x4201300
y.create.l HWIO_MSS_HI0_CH0_CMD_PTR_SD3_ADDR A:0x4201700
y.create.l HWIO_MSS_HI0_CH1_CMD_PTR_SD0_ADDR A:0x4200b04
y.create.l HWIO_MSS_HI0_CH1_CMD_PTR_SD1_ADDR A:0x4200f04
y.create.l HWIO_MSS_HI0_CH1_CMD_PTR_SD2_ADDR A:0x4201304
y.create.l HWIO_MSS_HI0_CH1_CMD_PTR_SD3_ADDR A:0x4201704
y.create.l HWIO_MSS_HI0_CH2_CMD_PTR_SD0_ADDR A:0x4200b08
y.create.l HWIO_MSS_HI0_CH2_CMD_PTR_SD1_ADDR A:0x4200f08
y.create.l HWIO_MSS_HI0_CH2_CMD_PTR_SD2_ADDR A:0x4201308
y.create.l HWIO_MSS_HI0_CH2_CMD_PTR_SD3_ADDR A:0x4201708
y.create.l HWIO_MSS_HI0_CH3_CMD_PTR_SD0_ADDR A:0x4200b0c
y.create.l HWIO_MSS_HI0_CH3_CMD_PTR_SD1_ADDR A:0x4200f0c
y.create.l HWIO_MSS_HI0_CH3_CMD_PTR_SD2_ADDR A:0x420130c
y.create.l HWIO_MSS_HI0_CH3_CMD_PTR_SD3_ADDR A:0x420170c
y.create.l HWIO_MSS_HI0_CH4_CMD_PTR_SD0_ADDR A:0x4200b10
y.create.l HWIO_MSS_HI0_CH4_CMD_PTR_SD1_ADDR A:0x4200f10
y.create.l HWIO_MSS_HI0_CH4_CMD_PTR_SD2_ADDR A:0x4201310
y.create.l HWIO_MSS_HI0_CH4_CMD_PTR_SD3_ADDR A:0x4201710
y.create.l HWIO_MSS_HI0_CH5_CMD_PTR_SD0_ADDR A:0x4200b14
y.create.l HWIO_MSS_HI0_CH5_CMD_PTR_SD1_ADDR A:0x4200f14
y.create.l HWIO_MSS_HI0_CH5_CMD_PTR_SD2_ADDR A:0x4201314
y.create.l HWIO_MSS_HI0_CH5_CMD_PTR_SD3_ADDR A:0x4201714
y.create.l HWIO_MSS_HI0_CH6_CMD_PTR_SD0_ADDR A:0x4200b18
y.create.l HWIO_MSS_HI0_CH6_CMD_PTR_SD1_ADDR A:0x4200f18
y.create.l HWIO_MSS_HI0_CH6_CMD_PTR_SD2_ADDR A:0x4201318
y.create.l HWIO_MSS_HI0_CH6_CMD_PTR_SD3_ADDR A:0x4201718
y.create.l HWIO_MSS_HI0_CH7_CMD_PTR_SD0_ADDR A:0x4200b1c
y.create.l HWIO_MSS_HI0_CH7_CMD_PTR_SD1_ADDR A:0x4200f1c
y.create.l HWIO_MSS_HI0_CH7_CMD_PTR_SD2_ADDR A:0x420131c
y.create.l HWIO_MSS_HI0_CH7_CMD_PTR_SD3_ADDR A:0x420171c
y.create.l HWIO_MSS_HI0_CH0_RSLT_SD0_ADDR A:0x4200b40
y.create.l HWIO_MSS_HI0_CH0_RSLT_SD1_ADDR A:0x4200f40
y.create.l HWIO_MSS_HI0_CH0_RSLT_SD2_ADDR A:0x4201340
y.create.l HWIO_MSS_HI0_CH0_RSLT_SD3_ADDR A:0x4201740
y.create.l HWIO_MSS_HI0_CH1_RSLT_SD0_ADDR A:0x4200b44
y.create.l HWIO_MSS_HI0_CH1_RSLT_SD1_ADDR A:0x4200f44
y.create.l HWIO_MSS_HI0_CH1_RSLT_SD2_ADDR A:0x4201344
y.create.l HWIO_MSS_HI0_CH1_RSLT_SD3_ADDR A:0x4201744
y.create.l HWIO_MSS_HI0_CH2_RSLT_SD0_ADDR A:0x4200b48
y.create.l HWIO_MSS_HI0_CH2_RSLT_SD1_ADDR A:0x4200f48
y.create.l HWIO_MSS_HI0_CH2_RSLT_SD2_ADDR A:0x4201348
y.create.l HWIO_MSS_HI0_CH2_RSLT_SD3_ADDR A:0x4201748
y.create.l HWIO_MSS_HI0_CH3_RSLT_SD0_ADDR A:0x4200b4c
y.create.l HWIO_MSS_HI0_CH3_RSLT_SD1_ADDR A:0x4200f4c
y.create.l HWIO_MSS_HI0_CH3_RSLT_SD2_ADDR A:0x420134c
y.create.l HWIO_MSS_HI0_CH3_RSLT_SD3_ADDR A:0x420174c
y.create.l HWIO_MSS_HI0_CH4_RSLT_SD0_ADDR A:0x4200b50
y.create.l HWIO_MSS_HI0_CH4_RSLT_SD1_ADDR A:0x4200f50
y.create.l HWIO_MSS_HI0_CH4_RSLT_SD2_ADDR A:0x4201350
y.create.l HWIO_MSS_HI0_CH4_RSLT_SD3_ADDR A:0x4201750
y.create.l HWIO_MSS_HI0_CH5_RSLT_SD0_ADDR A:0x4200b54
y.create.l HWIO_MSS_HI0_CH5_RSLT_SD1_ADDR A:0x4200f54
y.create.l HWIO_MSS_HI0_CH5_RSLT_SD2_ADDR A:0x4201354
y.create.l HWIO_MSS_HI0_CH5_RSLT_SD3_ADDR A:0x4201754
y.create.l HWIO_MSS_HI0_CH6_RSLT_SD0_ADDR A:0x4200b58
y.create.l HWIO_MSS_HI0_CH6_RSLT_SD1_ADDR A:0x4200f58
y.create.l HWIO_MSS_HI0_CH6_RSLT_SD2_ADDR A:0x4201358
y.create.l HWIO_MSS_HI0_CH6_RSLT_SD3_ADDR A:0x4201758
y.create.l HWIO_MSS_HI0_CH7_RSLT_SD0_ADDR A:0x4200b5c
y.create.l HWIO_MSS_HI0_CH7_RSLT_SD1_ADDR A:0x4200f5c
y.create.l HWIO_MSS_HI0_CH7_RSLT_SD2_ADDR A:0x420135c
y.create.l HWIO_MSS_HI0_CH7_RSLT_SD3_ADDR A:0x420175c
y.create.l HWIO_MSS_HI0_CH0_FLUSH_STATE0_SD0_ADDR A:0x4200b80
y.create.l HWIO_MSS_HI0_CH0_FLUSH_STATE0_SD1_ADDR A:0x4200f80
y.create.l HWIO_MSS_HI0_CH0_FLUSH_STATE0_SD2_ADDR A:0x4201380
y.create.l HWIO_MSS_HI0_CH0_FLUSH_STATE0_SD3_ADDR A:0x4201780
y.create.l HWIO_MSS_HI0_CH1_FLUSH_STATE0_SD0_ADDR A:0x4200b84
y.create.l HWIO_MSS_HI0_CH1_FLUSH_STATE0_SD1_ADDR A:0x4200f84
y.create.l HWIO_MSS_HI0_CH1_FLUSH_STATE0_SD2_ADDR A:0x4201384
y.create.l HWIO_MSS_HI0_CH1_FLUSH_STATE0_SD3_ADDR A:0x4201784
y.create.l HWIO_MSS_HI0_CH2_FLUSH_STATE0_SD0_ADDR A:0x4200b88
y.create.l HWIO_MSS_HI0_CH2_FLUSH_STATE0_SD1_ADDR A:0x4200f88
y.create.l HWIO_MSS_HI0_CH2_FLUSH_STATE0_SD2_ADDR A:0x4201388
y.create.l HWIO_MSS_HI0_CH2_FLUSH_STATE0_SD3_ADDR A:0x4201788
y.create.l HWIO_MSS_HI0_CH3_FLUSH_STATE0_SD0_ADDR A:0x4200b8c
y.create.l HWIO_MSS_HI0_CH3_FLUSH_STATE0_SD1_ADDR A:0x4200f8c
y.create.l HWIO_MSS_HI0_CH3_FLUSH_STATE0_SD2_ADDR A:0x420138c
y.create.l HWIO_MSS_HI0_CH3_FLUSH_STATE0_SD3_ADDR A:0x420178c
y.create.l HWIO_MSS_HI0_CH4_FLUSH_STATE0_SD0_ADDR A:0x4200b90
y.create.l HWIO_MSS_HI0_CH4_FLUSH_STATE0_SD1_ADDR A:0x4200f90
y.create.l HWIO_MSS_HI0_CH4_FLUSH_STATE0_SD2_ADDR A:0x4201390
y.create.l HWIO_MSS_HI0_CH4_FLUSH_STATE0_SD3_ADDR A:0x4201790
y.create.l HWIO_MSS_HI0_CH5_FLUSH_STATE0_SD0_ADDR A:0x4200b94
y.create.l HWIO_MSS_HI0_CH5_FLUSH_STATE0_SD1_ADDR A:0x4200f94
y.create.l HWIO_MSS_HI0_CH5_FLUSH_STATE0_SD2_ADDR A:0x4201394
y.create.l HWIO_MSS_HI0_CH5_FLUSH_STATE0_SD3_ADDR A:0x4201794
y.create.l HWIO_MSS_HI0_CH6_FLUSH_STATE0_SD0_ADDR A:0x4200b98
y.create.l HWIO_MSS_HI0_CH6_FLUSH_STATE0_SD1_ADDR A:0x4200f98
y.create.l HWIO_MSS_HI0_CH6_FLUSH_STATE0_SD2_ADDR A:0x4201398
y.create.l HWIO_MSS_HI0_CH6_FLUSH_STATE0_SD3_ADDR A:0x4201798
y.create.l HWIO_MSS_HI0_CH7_FLUSH_STATE0_SD0_ADDR A:0x4200b9c
y.create.l HWIO_MSS_HI0_CH7_FLUSH_STATE0_SD1_ADDR A:0x4200f9c
y.create.l HWIO_MSS_HI0_CH7_FLUSH_STATE0_SD2_ADDR A:0x420139c
y.create.l HWIO_MSS_HI0_CH7_FLUSH_STATE0_SD3_ADDR A:0x420179c
y.create.l HWIO_MSS_HI0_CH0_FLUSH_STATE1_SD0_ADDR A:0x4200bc0
y.create.l HWIO_MSS_HI0_CH0_FLUSH_STATE1_SD1_ADDR A:0x4200fc0
y.create.l HWIO_MSS_HI0_CH0_FLUSH_STATE1_SD2_ADDR A:0x42013c0
y.create.l HWIO_MSS_HI0_CH0_FLUSH_STATE1_SD3_ADDR A:0x42017c0
y.create.l HWIO_MSS_HI0_CH1_FLUSH_STATE1_SD0_ADDR A:0x4200bc4
y.create.l HWIO_MSS_HI0_CH1_FLUSH_STATE1_SD1_ADDR A:0x4200fc4
y.create.l HWIO_MSS_HI0_CH1_FLUSH_STATE1_SD2_ADDR A:0x42013c4
y.create.l HWIO_MSS_HI0_CH1_FLUSH_STATE1_SD3_ADDR A:0x42017c4
y.create.l HWIO_MSS_HI0_CH2_FLUSH_STATE1_SD0_ADDR A:0x4200bc8
y.create.l HWIO_MSS_HI0_CH2_FLUSH_STATE1_SD1_ADDR A:0x4200fc8
y.create.l HWIO_MSS_HI0_CH2_FLUSH_STATE1_SD2_ADDR A:0x42013c8
y.create.l HWIO_MSS_HI0_CH2_FLUSH_STATE1_SD3_ADDR A:0x42017c8
y.create.l HWIO_MSS_HI0_CH3_FLUSH_STATE1_SD0_ADDR A:0x4200bcc
y.create.l HWIO_MSS_HI0_CH3_FLUSH_STATE1_SD1_ADDR A:0x4200fcc
y.create.l HWIO_MSS_HI0_CH3_FLUSH_STATE1_SD2_ADDR A:0x42013cc
y.create.l HWIO_MSS_HI0_CH3_FLUSH_STATE1_SD3_ADDR A:0x42017cc
y.create.l HWIO_MSS_HI0_CH4_FLUSH_STATE1_SD0_ADDR A:0x4200bd0
y.create.l HWIO_MSS_HI0_CH4_FLUSH_STATE1_SD1_ADDR A:0x4200fd0
y.create.l HWIO_MSS_HI0_CH4_FLUSH_STATE1_SD2_ADDR A:0x42013d0
y.create.l HWIO_MSS_HI0_CH4_FLUSH_STATE1_SD3_ADDR A:0x42017d0
y.create.l HWIO_MSS_HI0_CH5_FLUSH_STATE1_SD0_ADDR A:0x4200bd4
y.create.l HWIO_MSS_HI0_CH5_FLUSH_STATE1_SD1_ADDR A:0x4200fd4
y.create.l HWIO_MSS_HI0_CH5_FLUSH_STATE1_SD2_ADDR A:0x42013d4
y.create.l HWIO_MSS_HI0_CH5_FLUSH_STATE1_SD3_ADDR A:0x42017d4
y.create.l HWIO_MSS_HI0_CH6_FLUSH_STATE1_SD0_ADDR A:0x4200bd8
y.create.l HWIO_MSS_HI0_CH6_FLUSH_STATE1_SD1_ADDR A:0x4200fd8
y.create.l HWIO_MSS_HI0_CH6_FLUSH_STATE1_SD2_ADDR A:0x42013d8
y.create.l HWIO_MSS_HI0_CH6_FLUSH_STATE1_SD3_ADDR A:0x42017d8
y.create.l HWIO_MSS_HI0_CH7_FLUSH_STATE1_SD0_ADDR A:0x4200bdc
y.create.l HWIO_MSS_HI0_CH7_FLUSH_STATE1_SD1_ADDR A:0x4200fdc
y.create.l HWIO_MSS_HI0_CH7_FLUSH_STATE1_SD2_ADDR A:0x42013dc
y.create.l HWIO_MSS_HI0_CH7_FLUSH_STATE1_SD3_ADDR A:0x42017dc
y.create.l HWIO_MSS_HI0_CH0_FLUSH_STATE3_SD0_ADDR A:0x4200c40
y.create.l HWIO_MSS_HI0_CH0_FLUSH_STATE3_SD1_ADDR A:0x4201040
y.create.l HWIO_MSS_HI0_CH0_FLUSH_STATE3_SD2_ADDR A:0x4201440
y.create.l HWIO_MSS_HI0_CH0_FLUSH_STATE3_SD3_ADDR A:0x4201840
y.create.l HWIO_MSS_HI0_CH1_FLUSH_STATE3_SD0_ADDR A:0x4200c44
y.create.l HWIO_MSS_HI0_CH1_FLUSH_STATE3_SD1_ADDR A:0x4201044
y.create.l HWIO_MSS_HI0_CH1_FLUSH_STATE3_SD2_ADDR A:0x4201444
y.create.l HWIO_MSS_HI0_CH1_FLUSH_STATE3_SD3_ADDR A:0x4201844
y.create.l HWIO_MSS_HI0_CH2_FLUSH_STATE3_SD0_ADDR A:0x4200c48
y.create.l HWIO_MSS_HI0_CH2_FLUSH_STATE3_SD1_ADDR A:0x4201048
y.create.l HWIO_MSS_HI0_CH2_FLUSH_STATE3_SD2_ADDR A:0x4201448
y.create.l HWIO_MSS_HI0_CH2_FLUSH_STATE3_SD3_ADDR A:0x4201848
y.create.l HWIO_MSS_HI0_CH3_FLUSH_STATE3_SD0_ADDR A:0x4200c4c
y.create.l HWIO_MSS_HI0_CH3_FLUSH_STATE3_SD1_ADDR A:0x420104c
y.create.l HWIO_MSS_HI0_CH3_FLUSH_STATE3_SD2_ADDR A:0x420144c
y.create.l HWIO_MSS_HI0_CH3_FLUSH_STATE3_SD3_ADDR A:0x420184c
y.create.l HWIO_MSS_HI0_CH4_FLUSH_STATE3_SD0_ADDR A:0x4200c50
y.create.l HWIO_MSS_HI0_CH4_FLUSH_STATE3_SD1_ADDR A:0x4201050
y.create.l HWIO_MSS_HI0_CH4_FLUSH_STATE3_SD2_ADDR A:0x4201450
y.create.l HWIO_MSS_HI0_CH4_FLUSH_STATE3_SD3_ADDR A:0x4201850
y.create.l HWIO_MSS_HI0_CH5_FLUSH_STATE3_SD0_ADDR A:0x4200c54
y.create.l HWIO_MSS_HI0_CH5_FLUSH_STATE3_SD1_ADDR A:0x4201054
y.create.l HWIO_MSS_HI0_CH5_FLUSH_STATE3_SD2_ADDR A:0x4201454
y.create.l HWIO_MSS_HI0_CH5_FLUSH_STATE3_SD3_ADDR A:0x4201854
y.create.l HWIO_MSS_HI0_CH6_FLUSH_STATE3_SD0_ADDR A:0x4200c58
y.create.l HWIO_MSS_HI0_CH6_FLUSH_STATE3_SD1_ADDR A:0x4201058
y.create.l HWIO_MSS_HI0_CH6_FLUSH_STATE3_SD2_ADDR A:0x4201458
y.create.l HWIO_MSS_HI0_CH6_FLUSH_STATE3_SD3_ADDR A:0x4201858
y.create.l HWIO_MSS_HI0_CH7_FLUSH_STATE3_SD0_ADDR A:0x4200c5c
y.create.l HWIO_MSS_HI0_CH7_FLUSH_STATE3_SD1_ADDR A:0x420105c
y.create.l HWIO_MSS_HI0_CH7_FLUSH_STATE3_SD2_ADDR A:0x420145c
y.create.l HWIO_MSS_HI0_CH7_FLUSH_STATE3_SD3_ADDR A:0x420185c
y.create.l HWIO_MSS_HI0_CH0_FLUSH_STATE4_SD0_ADDR A:0x4200c80
y.create.l HWIO_MSS_HI0_CH0_FLUSH_STATE4_SD1_ADDR A:0x4201080
y.create.l HWIO_MSS_HI0_CH0_FLUSH_STATE4_SD2_ADDR A:0x4201480
y.create.l HWIO_MSS_HI0_CH0_FLUSH_STATE4_SD3_ADDR A:0x4201880
y.create.l HWIO_MSS_HI0_CH1_FLUSH_STATE4_SD0_ADDR A:0x4200c84
y.create.l HWIO_MSS_HI0_CH1_FLUSH_STATE4_SD1_ADDR A:0x4201084
y.create.l HWIO_MSS_HI0_CH1_FLUSH_STATE4_SD2_ADDR A:0x4201484
y.create.l HWIO_MSS_HI0_CH1_FLUSH_STATE4_SD3_ADDR A:0x4201884
y.create.l HWIO_MSS_HI0_CH2_FLUSH_STATE4_SD0_ADDR A:0x4200c88
y.create.l HWIO_MSS_HI0_CH2_FLUSH_STATE4_SD1_ADDR A:0x4201088
y.create.l HWIO_MSS_HI0_CH2_FLUSH_STATE4_SD2_ADDR A:0x4201488
y.create.l HWIO_MSS_HI0_CH2_FLUSH_STATE4_SD3_ADDR A:0x4201888
y.create.l HWIO_MSS_HI0_CH3_FLUSH_STATE4_SD0_ADDR A:0x4200c8c
y.create.l HWIO_MSS_HI0_CH3_FLUSH_STATE4_SD1_ADDR A:0x420108c
y.create.l HWIO_MSS_HI0_CH3_FLUSH_STATE4_SD2_ADDR A:0x420148c
y.create.l HWIO_MSS_HI0_CH3_FLUSH_STATE4_SD3_ADDR A:0x420188c
y.create.l HWIO_MSS_HI0_CH4_FLUSH_STATE4_SD0_ADDR A:0x4200c90
y.create.l HWIO_MSS_HI0_CH4_FLUSH_STATE4_SD1_ADDR A:0x4201090
y.create.l HWIO_MSS_HI0_CH4_FLUSH_STATE4_SD2_ADDR A:0x4201490
y.create.l HWIO_MSS_HI0_CH4_FLUSH_STATE4_SD3_ADDR A:0x4201890
y.create.l HWIO_MSS_HI0_CH5_FLUSH_STATE4_SD0_ADDR A:0x4200c94
y.create.l HWIO_MSS_HI0_CH5_FLUSH_STATE4_SD1_ADDR A:0x4201094
y.create.l HWIO_MSS_HI0_CH5_FLUSH_STATE4_SD2_ADDR A:0x4201494
y.create.l HWIO_MSS_HI0_CH5_FLUSH_STATE4_SD3_ADDR A:0x4201894
y.create.l HWIO_MSS_HI0_CH6_FLUSH_STATE4_SD0_ADDR A:0x4200c98
y.create.l HWIO_MSS_HI0_CH6_FLUSH_STATE4_SD1_ADDR A:0x4201098
y.create.l HWIO_MSS_HI0_CH6_FLUSH_STATE4_SD2_ADDR A:0x4201498
y.create.l HWIO_MSS_HI0_CH6_FLUSH_STATE4_SD3_ADDR A:0x4201898
y.create.l HWIO_MSS_HI0_CH7_FLUSH_STATE4_SD0_ADDR A:0x4200c9c
y.create.l HWIO_MSS_HI0_CH7_FLUSH_STATE4_SD1_ADDR A:0x420109c
y.create.l HWIO_MSS_HI0_CH7_FLUSH_STATE4_SD2_ADDR A:0x420149c
y.create.l HWIO_MSS_HI0_CH7_FLUSH_STATE4_SD3_ADDR A:0x420189c
y.create.l HWIO_MSS_HI0_CH0_FLUSH_STATE5_SD0_ADDR A:0x4200cc0
y.create.l HWIO_MSS_HI0_CH0_FLUSH_STATE5_SD1_ADDR A:0x42010c0
y.create.l HWIO_MSS_HI0_CH0_FLUSH_STATE5_SD2_ADDR A:0x42014c0
y.create.l HWIO_MSS_HI0_CH0_FLUSH_STATE5_SD3_ADDR A:0x42018c0
y.create.l HWIO_MSS_HI0_CH1_FLUSH_STATE5_SD0_ADDR A:0x4200cc4
y.create.l HWIO_MSS_HI0_CH1_FLUSH_STATE5_SD1_ADDR A:0x42010c4
y.create.l HWIO_MSS_HI0_CH1_FLUSH_STATE5_SD2_ADDR A:0x42014c4
y.create.l HWIO_MSS_HI0_CH1_FLUSH_STATE5_SD3_ADDR A:0x42018c4
y.create.l HWIO_MSS_HI0_CH2_FLUSH_STATE5_SD0_ADDR A:0x4200cc8
y.create.l HWIO_MSS_HI0_CH2_FLUSH_STATE5_SD1_ADDR A:0x42010c8
y.create.l HWIO_MSS_HI0_CH2_FLUSH_STATE5_SD2_ADDR A:0x42014c8
y.create.l HWIO_MSS_HI0_CH2_FLUSH_STATE5_SD3_ADDR A:0x42018c8
y.create.l HWIO_MSS_HI0_CH3_FLUSH_STATE5_SD0_ADDR A:0x4200ccc
y.create.l HWIO_MSS_HI0_CH3_FLUSH_STATE5_SD1_ADDR A:0x42010cc
y.create.l HWIO_MSS_HI0_CH3_FLUSH_STATE5_SD2_ADDR A:0x42014cc
y.create.l HWIO_MSS_HI0_CH3_FLUSH_STATE5_SD3_ADDR A:0x42018cc
y.create.l HWIO_MSS_HI0_CH4_FLUSH_STATE5_SD0_ADDR A:0x4200cd0
y.create.l HWIO_MSS_HI0_CH4_FLUSH_STATE5_SD1_ADDR A:0x42010d0
y.create.l HWIO_MSS_HI0_CH4_FLUSH_STATE5_SD2_ADDR A:0x42014d0
y.create.l HWIO_MSS_HI0_CH4_FLUSH_STATE5_SD3_ADDR A:0x42018d0
y.create.l HWIO_MSS_HI0_CH5_FLUSH_STATE5_SD0_ADDR A:0x4200cd4
y.create.l HWIO_MSS_HI0_CH5_FLUSH_STATE5_SD1_ADDR A:0x42010d4
y.create.l HWIO_MSS_HI0_CH5_FLUSH_STATE5_SD2_ADDR A:0x42014d4
y.create.l HWIO_MSS_HI0_CH5_FLUSH_STATE5_SD3_ADDR A:0x42018d4
y.create.l HWIO_MSS_HI0_CH6_FLUSH_STATE5_SD0_ADDR A:0x4200cd8
y.create.l HWIO_MSS_HI0_CH6_FLUSH_STATE5_SD1_ADDR A:0x42010d8
y.create.l HWIO_MSS_HI0_CH6_FLUSH_STATE5_SD2_ADDR A:0x42014d8
y.create.l HWIO_MSS_HI0_CH6_FLUSH_STATE5_SD3_ADDR A:0x42018d8
y.create.l HWIO_MSS_HI0_CH7_FLUSH_STATE5_SD0_ADDR A:0x4200cdc
y.create.l HWIO_MSS_HI0_CH7_FLUSH_STATE5_SD1_ADDR A:0x42010dc
y.create.l HWIO_MSS_HI0_CH7_FLUSH_STATE5_SD2_ADDR A:0x42014dc
y.create.l HWIO_MSS_HI0_CH7_FLUSH_STATE5_SD3_ADDR A:0x42018dc
y.create.l HWIO_MSS_HI0_SEC_DOMAIN_IRQ_STATUS_SD0_ADDR A:0x4200e80
y.create.l HWIO_MSS_HI0_SEC_DOMAIN_IRQ_STATUS_SD1_ADDR A:0x4201280
y.create.l HWIO_MSS_HI0_SEC_DOMAIN_IRQ_STATUS_SD2_ADDR A:0x4201680
y.create.l HWIO_MSS_HI0_SEC_DOMAIN_IRQ_STATUS_SD3_ADDR A:0x4201a80
y.create.l HWIO_MSS_HI0_CH0_RSLT_CONF_SD0_ADDR A:0x4200e00
y.create.l HWIO_MSS_HI0_CH0_RSLT_CONF_SD1_ADDR A:0x4201200
y.create.l HWIO_MSS_HI0_CH0_RSLT_CONF_SD2_ADDR A:0x4201600
y.create.l HWIO_MSS_HI0_CH0_RSLT_CONF_SD3_ADDR A:0x4201a00
y.create.l HWIO_MSS_HI0_CH1_RSLT_CONF_SD0_ADDR A:0x4200e04
y.create.l HWIO_MSS_HI0_CH1_RSLT_CONF_SD1_ADDR A:0x4201204
y.create.l HWIO_MSS_HI0_CH1_RSLT_CONF_SD2_ADDR A:0x4201604
y.create.l HWIO_MSS_HI0_CH1_RSLT_CONF_SD3_ADDR A:0x4201a04
y.create.l HWIO_MSS_HI0_CH2_RSLT_CONF_SD0_ADDR A:0x4200e08
y.create.l HWIO_MSS_HI0_CH2_RSLT_CONF_SD1_ADDR A:0x4201208
y.create.l HWIO_MSS_HI0_CH2_RSLT_CONF_SD2_ADDR A:0x4201608
y.create.l HWIO_MSS_HI0_CH2_RSLT_CONF_SD3_ADDR A:0x4201a08
y.create.l HWIO_MSS_HI0_CH3_RSLT_CONF_SD0_ADDR A:0x4200e0c
y.create.l HWIO_MSS_HI0_CH3_RSLT_CONF_SD1_ADDR A:0x420120c
y.create.l HWIO_MSS_HI0_CH3_RSLT_CONF_SD2_ADDR A:0x420160c
y.create.l HWIO_MSS_HI0_CH3_RSLT_CONF_SD3_ADDR A:0x4201a0c
y.create.l HWIO_MSS_HI0_CH4_RSLT_CONF_SD0_ADDR A:0x4200e10
y.create.l HWIO_MSS_HI0_CH4_RSLT_CONF_SD1_ADDR A:0x4201210
y.create.l HWIO_MSS_HI0_CH4_RSLT_CONF_SD2_ADDR A:0x4201610
y.create.l HWIO_MSS_HI0_CH4_RSLT_CONF_SD3_ADDR A:0x4201a10
y.create.l HWIO_MSS_HI0_CH5_RSLT_CONF_SD0_ADDR A:0x4200e14
y.create.l HWIO_MSS_HI0_CH5_RSLT_CONF_SD1_ADDR A:0x4201214
y.create.l HWIO_MSS_HI0_CH5_RSLT_CONF_SD2_ADDR A:0x4201614
y.create.l HWIO_MSS_HI0_CH5_RSLT_CONF_SD3_ADDR A:0x4201a14
y.create.l HWIO_MSS_HI0_CH6_RSLT_CONF_SD0_ADDR A:0x4200e18
y.create.l HWIO_MSS_HI0_CH6_RSLT_CONF_SD1_ADDR A:0x4201218
y.create.l HWIO_MSS_HI0_CH6_RSLT_CONF_SD2_ADDR A:0x4201618
y.create.l HWIO_MSS_HI0_CH6_RSLT_CONF_SD3_ADDR A:0x4201a18
y.create.l HWIO_MSS_HI0_CH7_RSLT_CONF_SD0_ADDR A:0x4200e1c
y.create.l HWIO_MSS_HI0_CH7_RSLT_CONF_SD1_ADDR A:0x420121c
y.create.l HWIO_MSS_HI0_CH7_RSLT_CONF_SD2_ADDR A:0x420161c
y.create.l HWIO_MSS_HI0_CH7_RSLT_CONF_SD3_ADDR A:0x4201a1c
y.create.l HWIO_MSS_HI0_CH0_STATUS_SD0_ADDR A:0x4200d00
y.create.l HWIO_MSS_HI0_CH0_STATUS_SD1_ADDR A:0x4201100
y.create.l HWIO_MSS_HI0_CH0_STATUS_SD2_ADDR A:0x4201500
y.create.l HWIO_MSS_HI0_CH0_STATUS_SD3_ADDR A:0x4201900
y.create.l HWIO_MSS_HI0_CH1_STATUS_SD0_ADDR A:0x4200d04
y.create.l HWIO_MSS_HI0_CH1_STATUS_SD1_ADDR A:0x4201104
y.create.l HWIO_MSS_HI0_CH1_STATUS_SD2_ADDR A:0x4201504
y.create.l HWIO_MSS_HI0_CH1_STATUS_SD3_ADDR A:0x4201904
y.create.l HWIO_MSS_HI0_CH2_STATUS_SD0_ADDR A:0x4200d08
y.create.l HWIO_MSS_HI0_CH2_STATUS_SD1_ADDR A:0x4201108
y.create.l HWIO_MSS_HI0_CH2_STATUS_SD2_ADDR A:0x4201508
y.create.l HWIO_MSS_HI0_CH2_STATUS_SD3_ADDR A:0x4201908
y.create.l HWIO_MSS_HI0_CH3_STATUS_SD0_ADDR A:0x4200d0c
y.create.l HWIO_MSS_HI0_CH3_STATUS_SD1_ADDR A:0x420110c
y.create.l HWIO_MSS_HI0_CH3_STATUS_SD2_ADDR A:0x420150c
y.create.l HWIO_MSS_HI0_CH3_STATUS_SD3_ADDR A:0x420190c
y.create.l HWIO_MSS_HI0_CH4_STATUS_SD0_ADDR A:0x4200d10
y.create.l HWIO_MSS_HI0_CH4_STATUS_SD1_ADDR A:0x4201110
y.create.l HWIO_MSS_HI0_CH4_STATUS_SD2_ADDR A:0x4201510
y.create.l HWIO_MSS_HI0_CH4_STATUS_SD3_ADDR A:0x4201910
y.create.l HWIO_MSS_HI0_CH5_STATUS_SD0_ADDR A:0x4200d14
y.create.l HWIO_MSS_HI0_CH5_STATUS_SD1_ADDR A:0x4201114
y.create.l HWIO_MSS_HI0_CH5_STATUS_SD2_ADDR A:0x4201514
y.create.l HWIO_MSS_HI0_CH5_STATUS_SD3_ADDR A:0x4201914
y.create.l HWIO_MSS_HI0_CH6_STATUS_SD0_ADDR A:0x4200d18
y.create.l HWIO_MSS_HI0_CH6_STATUS_SD1_ADDR A:0x4201118
y.create.l HWIO_MSS_HI0_CH6_STATUS_SD2_ADDR A:0x4201518
y.create.l HWIO_MSS_HI0_CH6_STATUS_SD3_ADDR A:0x4201918
y.create.l HWIO_MSS_HI0_CH7_STATUS_SD0_ADDR A:0x4200d1c
y.create.l HWIO_MSS_HI0_CH7_STATUS_SD1_ADDR A:0x420111c
y.create.l HWIO_MSS_HI0_CH7_STATUS_SD2_ADDR A:0x420151c
y.create.l HWIO_MSS_HI0_CH7_STATUS_SD3_ADDR A:0x420191c
y.create.l HWIO_MSS_HI0_CH0_CONF_ADDR A:0x4200d40
y.create.l HWIO_MSS_HI0_CH1_CONF_ADDR A:0x4200d44
y.create.l HWIO_MSS_HI0_CH2_CONF_ADDR A:0x4200d48
y.create.l HWIO_MSS_HI0_CH3_CONF_ADDR A:0x4200d4c
y.create.l HWIO_MSS_HI0_CH4_CONF_ADDR A:0x4200d50
y.create.l HWIO_MSS_HI0_CH5_CONF_ADDR A:0x4200d54
y.create.l HWIO_MSS_HI0_CH6_CONF_ADDR A:0x4200d58
y.create.l HWIO_MSS_HI0_CH7_CONF_ADDR A:0x4200d5c
y.create.l HWIO_MSS_HI0_CH0_DBG_0_ADDR A:0x4200d80
y.create.l HWIO_MSS_HI0_CH1_DBG_0_ADDR A:0x4200d84
y.create.l HWIO_MSS_HI0_CH2_DBG_0_ADDR A:0x4200d88
y.create.l HWIO_MSS_HI0_CH3_DBG_0_ADDR A:0x4200d8c
y.create.l HWIO_MSS_HI0_CH4_DBG_0_ADDR A:0x4200d90
y.create.l HWIO_MSS_HI0_CH5_DBG_0_ADDR A:0x4200d94
y.create.l HWIO_MSS_HI0_CH6_DBG_0_ADDR A:0x4200d98
y.create.l HWIO_MSS_HI0_CH7_DBG_0_ADDR A:0x4200d9c
y.create.l HWIO_MSS_HI0_CH0_DBG_1_ADDR A:0x4200dc0
y.create.l HWIO_MSS_HI0_CH1_DBG_1_ADDR A:0x4200dc4
y.create.l HWIO_MSS_HI0_CH2_DBG_1_ADDR A:0x4200dc8
y.create.l HWIO_MSS_HI0_CH3_DBG_1_ADDR A:0x4200dcc
y.create.l HWIO_MSS_HI0_CH4_DBG_1_ADDR A:0x4200dd0
y.create.l HWIO_MSS_HI0_CH5_DBG_1_ADDR A:0x4200dd4
y.create.l HWIO_MSS_HI0_CH6_DBG_1_ADDR A:0x4200dd8
y.create.l HWIO_MSS_HI0_CH7_DBG_1_ADDR A:0x4200ddc
y.create.l HWIO_MSS_HI0_CI0_CONF_ADDR A:0x4200e90
y.create.l HWIO_MSS_HI0_CI1_CONF_ADDR A:0x4200e94
y.create.l HWIO_MSS_HI0_CI2_CONF_ADDR A:0x4200e98
y.create.l HWIO_MSS_HI0_CI3_CONF_ADDR A:0x4200e9c
y.create.l HWIO_MSS_HI0_CI4_CONF_ADDR A:0x4200ea0
y.create.l HWIO_MSS_HI0_CI5_CONF_ADDR A:0x4200ea4
y.create.l HWIO_MSS_HI0_CI6_CONF_ADDR A:0x4200ea8
y.create.l HWIO_MSS_HI0_CI7_CONF_ADDR A:0x4200eac
y.create.l HWIO_MSS_HI0_CI0_DBG_ERR_ADDR A:0x4200eb0
y.create.l HWIO_MSS_HI0_CI1_DBG_ERR_ADDR A:0x4200eb4
y.create.l HWIO_MSS_HI0_CI2_DBG_ERR_ADDR A:0x4200eb8
y.create.l HWIO_MSS_HI0_CI3_DBG_ERR_ADDR A:0x4200ebc
y.create.l HWIO_MSS_HI0_CI4_DBG_ERR_ADDR A:0x4200ec0
y.create.l HWIO_MSS_HI0_CI5_DBG_ERR_ADDR A:0x4200ec4
y.create.l HWIO_MSS_HI0_CI6_DBG_ERR_ADDR A:0x4200ec8
y.create.l HWIO_MSS_HI0_CI7_DBG_ERR_ADDR A:0x4200ecc
y.create.l HWIO_MSS_HI0_CRCI_DBG_ADDR A:0x4200ed0
y.create.l HWIO_MSS_HI0_CRCI_STATUS_ADDR A:0x4200ed4
y.create.l HWIO_MSS_HI0_GP_CTL_ADDR A:0x4200ed8
y.create.l HWIO_MSS_HI0_GP_STATUS_ADDR A:0x4200edc
y.create.l HWIO_MSS_HI0_GLBL_DBG_CMD_ENG_ADDR A:0x4200ee0
y.create.l HWIO_MSS_HI0_GLBL_DBG_REQ_ENG_ADDR A:0x4200ee4
y.create.l HWIO_MSS_HI0_GLBL_DBG_XFR_ENG_ADDR A:0x4200ee8
y.create.l HWIO_MSS_HI0_GLBL_DBG_CHAN_BLK_ADDR A:0x4200eec
y.create.l HWIO_MSS_HI0_GLBL_DBG_CHAN_BLK_CLR_ADDR A:0x4200ef0
y.create.l HWIO_MSS_HI0_GLBL_DBG_TEST_SEL_ADDR A:0x4200ef4
y.create.l HWIO_MSS_NAV_CLK_ENABLE_ADDR A:0x42f8000
y.create.l HWIO_MSS_NAV_CLK_RESET_ADDR A:0x42f8004
y.create.l HWIO_MSS_NAV_CLK_CTL_ADDR A:0x42f8008
y.create.l HWIO_MSS_NAV_CLK_FRAC31_M_ADDR A:0x42f800c
y.create.l HWIO_MSS_NAV_CLK_FRAC31_NOT_2D_ADDR A:0x42f8010
y.create.l HWIO_MSS_NAV_CLK_FRAC31_NOT_N_MINUS_M_ADDR A:0x42f8014
y.create.l HWIO_MSS_NAV_CLK_FRAC31_UPDATE_ADDR A:0x42f8018
y.create.l HWIO_MSS_NAV_CLK_GDS_ADDR A:0x42f801c
y.create.l HWIO_MSS_NAV_CLK_IPCAT_ADDR A:0x42f8020
y.create.l HWIO_MSS_NAV_CLK_AXI_BRIDGE_STATUS_ADDR A:0x42f8024
y.create.l HWIO_MSS_GNSS_ADC_CMD0_ADDR A:0x42f0000
y.create.l HWIO_MSS_GNSS_ADC_CMD1_ADDR A:0x42f0004
y.create.l HWIO_MSS_GNSS_ADC_CMD2_ADDR A:0x42f0008
y.create.l HWIO_MSS_GNSS_ADC_CMD3_ADDR A:0x42f000c
y.create.l HWIO_MSS_GNSS_ADC_IDDQ_ADDR A:0x42f0010
y.create.l HWIO_MSS_NAV_PLL4_PLLMODE_ADDR A:0x42f8800
y.create.l HWIO_MSS_NAV_PLL4_L_VAL_ADDR A:0x42f8804
y.create.l HWIO_MSS_NAV_PLL4_ALPHA_VAL_L_ADDR A:0x42f8808
y.create.l HWIO_MSS_NAV_PLL4_ALPHA_VAL_H_ADDR A:0x42f880c
y.create.l HWIO_MSS_NAV_PLL4_USER_CTL_ADDR A:0x42f8810
y.create.l HWIO_MSS_NAV_PLL4_USER_CTL_H_ADDR A:0x42f8814
y.create.l HWIO_MSS_NAV_PLL4_CONFIG_CTL_ADDR A:0x42f8818
y.create.l HWIO_MSS_NAV_PLL4_TEST_CTL_ADDR A:0x42f881c
y.create.l HWIO_MSS_NAV_PLL4_STATUS_ADDR A:0x42f8824
y.create.l HWIO_MSS_STMR_STATUS0_RD_ADDR A:0x42000c0
y.create.l HWIO_MSS_STMR_STATUS1_RD_ADDR A:0x42000c4
y.create.l HWIO_MSS_STMR_STATUS2_RD_ADDR A:0x42000c8
y.create.l HWIO_MSS_STMR_STATUS3_RD_ADDR A:0x42000cc
y.create.l HWIO_MSS_STMR_STATUS4_RD_ADDR A:0x42000d0
y.create.l HWIO_MSS_STMR_STATUS5_RD_ADDR A:0x42000d4
y.create.l HWIO_MSS_STMR_STATUS6_RD_ADDR A:0x42000d8
y.create.l HWIO_MSS_STMR_STATUS7_RD_ADDR A:0x42000dc
y.create.l HWIO_MSS_STMR_STATUS8_RD_ADDR A:0x42000e0
y.create.l HWIO_MSS_STMR_STATUS9_RD_ADDR A:0x42000e4
y.create.l HWIO_MSS_STMR_STATUS10_RD_ADDR A:0x42000e8
y.create.l HWIO_MSS_STMR_STATUS11_RD_ADDR A:0x42000ec
y.create.l HWIO_TX_ENABLE_ADDR A:0x4380000
y.create.l HWIO_TX_MEM_ACCESS_CFG_ADDR A:0x4380004
y.create.l HWIO_TX_MEM_PAGE_ADDR A:0x4380008
y.create.l HWIO_TX_AXI_WR_INTF_EVENT_ADDR A:0x438000c
y.create.l HWIO_TX_STMR_TRIG_FRAC_CNT_0_ADDR A:0x4380010
y.create.l HWIO_TX_STMR_TRIG_FRAC_CNT_1_ADDR A:0x4380014
y.create.l HWIO_TX_FRAME_STB_FRAC_CNT_0_ADDR A:0x4380018
y.create.l HWIO_TX_FRAME_STB_FRAC_CNT_1_ADDR A:0x438001c
y.create.l HWIO_TX_MISR_CTRL_ADDR A:0x4380020
y.create.l HWIO_TX_MISR_RD_DATA_ADDR A:0x4380024
y.create.l HWIO_TX_MISR_CAP_EN_ADDR A:0x4380028
y.create.l HWIO_HARQ_DONE_STATUS_ADDR A:0x438002c
y.create.l HWIO_TX_MODE_0_ADDR A:0x4380030
y.create.l HWIO_TX_MODE_1_ADDR A:0x4380034
y.create.l HWIO_TX_MODE_COMMON_ADDR A:0x4380038
y.create.l HWIO_TX_ENABLE_GSM_0_ADDR A:0x438003c
y.create.l HWIO_TX_ENABLE_GSM_1_ADDR A:0x4380040
y.create.l HWIO_TX_TDS_CTRL_ADDR A:0x4380044
y.create.l HWIO_TX_MEM_TEST_WR_ADDR_ADDR A:0x4380048
y.create.l HWIO_TX_MEM_TEST_WR_ADDR_STATUS_ADDR A:0x438004c
y.create.l HWIO_TX_MEM_TEST_RD_ADDR A:0x4380050
y.create.l HWIO_TX_MEM_TEST_RD_ADDR_ADDR A:0x4380054
y.create.l HWIO_TX_MEM_TEST_RD_ADDR_STATUS_ADDR A:0x4380058
y.create.l HWIO_TX_SW_AHB_EVENT_ADDR0_ADDR A:0x4380060
y.create.l HWIO_TX_SW_AHB_EVENT_ADDR1_ADDR A:0x4380064
y.create.l HWIO_TX_SW_AHB_EVENT_ADDR2_ADDR A:0x4380068
y.create.l HWIO_TX_SW_AHB_EVENT_ADDR3_ADDR A:0x438006c
y.create.l HWIO_TX_SW_AHB_EVENT_ADDR4_ADDR A:0x4380070
y.create.l HWIO_TX_SW_AHB_EVENT_ADDR5_ADDR A:0x4380074
y.create.l HWIO_TX_SW_AHB_EVENT_ADDR6_ADDR A:0x4380078
y.create.l HWIO_TX_SW_AHB_EVENT_ADDR7_ADDR A:0x438007c
y.create.l HWIO_TX_A2_AHB_EVENT_ADDR_ADDR A:0x4380080
y.create.l HWIO_TX_EVENT_LOG_EN_ADDR A:0x4380084
y.create.l HWIO_TX_EVENT_SEL_0_ADDR A:0x4380088
y.create.l HWIO_TX_EVENT_SEL_1_ADDR A:0x438008c
y.create.l HWIO_TX_TESTBUS_SEL_ADDR A:0x4380090
y.create.l HWIO_TX_TESTBUS_RD_DATA_ADDR A:0x4380094
y.create.l HWIO_TX_TESTBUS_RD_DATA_MASK_ADDR A:0x4380098
y.create.l HWIO_TX_ERROR_IRQ_EN_ADDR A:0x438009c
y.create.l HWIO_TX_ERROR_IRQ_CLEAR_ADDR A:0x43800a0
y.create.l HWIO_TX_ERROR_IRQ_STATUS_ADDR A:0x43800a4
y.create.l HWIO_TX_STATUS_RD_ADDR A:0x43800a8
y.create.l HWIO_TX_DEBUG_IRQ_EN_ADDR A:0x43800ac
y.create.l HWIO_TX_DEBUG_IRQ_CLEAR_ADDR A:0x43800b0
y.create.l HWIO_TX_DEBUG_IRQ_STATUS_ADDR A:0x43800b4
y.create.l HWIO_TX_MODE_OFDMA_ADDR A:0x43800bc
y.create.l HWIO_TX_TECH_MUX_CTRL_ADDR A:0x43800c0
y.create.l HWIO_TX_AXI_RD0_INTF_CTL_ADDR A:0x43800c8
y.create.l HWIO_TX_AXI_RD0_INTF_EVENT_ADDR A:0x43800cc
y.create.l HWIO_TX_AXI_RD1_INTF_CTL_ADDR A:0x43800d0
y.create.l HWIO_TX_AXI_RD1_INTF_EVENT_ADDR A:0x43800d4
y.create.l HWIO_TX_SW_RESET_ENC_MOD_ADDR A:0x43800e0
y.create.l HWIO_TX_SW_RESET_TXC_TXR_0_ADDR A:0x43800e4
y.create.l HWIO_TX_SW_RESET_TXC_TXR_1_ADDR A:0x43800e8
y.create.l HWIO_TX_ENC_CLK_INIT_ADDR A:0x43800ec
y.create.l HWIO_TX_C2K_MODE_ADDR A:0x4381000
y.create.l HWIO_TX_TDS_NEW_FRAME_SW_ADDR A:0x4381064
y.create.l HWIO_TX_UNIFIED_DCH_RACH_ENC_TRIGGER_ADDR A:0x4381068
y.create.l HWIO_TX_TDS_ERUCCH_ENC_TRIGGER_ADDR A:0x438106c
y.create.l HWIO_TX_1X_ENC_TRIGGER_ADDR A:0x4381070
y.create.l HWIO_TX_DO_ENC_TRIGGER_ADDR A:0x4381074
y.create.l HWIO_TX_DO_CARRIER_CONFIG_ADDR A:0x4381078
y.create.l HWIO_TX_UNIFIED_ENC_NUM_ACTIVE_TRCHS_ADDR A:0x438107c
y.create.l HWIO_TX_UNIFIED_ENC_ENDIAN_FRMT_CTL_ADDR A:0x4381080
y.create.l HWIO_TX_UNIFIED_ENC_CIPHER_CK0_0_ADDR A:0x4381084
y.create.l HWIO_TX_UNIFIED_ENC_CIPHER_CK0_1_ADDR A:0x4381088
y.create.l HWIO_TX_UNIFIED_ENC_CIPHER_CK0_2_ADDR A:0x438108c
y.create.l HWIO_TX_UNIFIED_ENC_CIPHER_CK0_3_ADDR A:0x4381090
y.create.l HWIO_TX_UNIFIED_ENC_CIPHER_CK1_0_ADDR A:0x4381094
y.create.l HWIO_TX_UNIFIED_ENC_CIPHER_CK1_1_ADDR A:0x4381098
y.create.l HWIO_TX_UNIFIED_ENC_CIPHER_CK1_2_ADDR A:0x438109c
y.create.l HWIO_TX_UNIFIED_ENC_CIPHER_CK1_3_ADDR A:0x43810a0
y.create.l HWIO_TX_UNIFIED_ENC_CIPHER_CK2_0_ADDR A:0x43810a4
y.create.l HWIO_TX_UNIFIED_ENC_CIPHER_CK2_1_ADDR A:0x43810a8
y.create.l HWIO_TX_UNIFIED_ENC_CIPHER_CK2_2_ADDR A:0x43810ac
y.create.l HWIO_TX_UNIFIED_ENC_CIPHER_CK2_3_ADDR A:0x43810b0
y.create.l HWIO_TX_UNIFIED_ENC_CIPHER_CK3_0_ADDR A:0x43810b4
y.create.l HWIO_TX_UNIFIED_ENC_CIPHER_CK3_1_ADDR A:0x43810b8
y.create.l HWIO_TX_UNIFIED_ENC_CIPHER_CK3_2_ADDR A:0x43810bc
y.create.l HWIO_TX_UNIFIED_ENC_CIPHER_CK3_3_ADDR A:0x43810c0
y.create.l HWIO_TX_UNIFIED_ENC_CIPHER_CK4_0_ADDR A:0x43810c4
y.create.l HWIO_TX_UNIFIED_ENC_CIPHER_CK4_1_ADDR A:0x43810c8
y.create.l HWIO_TX_UNIFIED_ENC_CIPHER_CK4_2_ADDR A:0x43810cc
y.create.l HWIO_TX_UNIFIED_ENC_CIPHER_CK4_3_ADDR A:0x43810d0
y.create.l HWIO_TX_UNIFIED_ENC_CIPHER_CK5_0_ADDR A:0x43810d4
y.create.l HWIO_TX_UNIFIED_ENC_CIPHER_CK5_1_ADDR A:0x43810d8
y.create.l HWIO_TX_UNIFIED_ENC_CIPHER_CK5_2_ADDR A:0x43810dc
y.create.l HWIO_TX_UNIFIED_ENC_CIPHER_CK5_3_ADDR A:0x43810e0
y.create.l HWIO_TX_UNIFIED_ENC_ERAM_INCRACC_INIT_ADDR A:0x43810e4
y.create.l HWIO_TX_UNIFIED_ENC_FILLER_POLARITY_ADDR A:0x43810e8
y.create.l HWIO_TX_TDS_TTI_ERUCCH_ADDR A:0x43810ec
y.create.l HWIO_TX_UNIFIED_ENC_EUL_CODING_PARAM_BANK0_ADDR A:0x43810f0
y.create.l HWIO_TX_UNIFIED_ENC_EUL_CODING_PARAM_BANK1_ADDR A:0x43810f4
y.create.l HWIO_TX_UNIFIED_ENC_EUL_CODE_SEG_SIZE_BANK0_ADDR A:0x43810f8
y.create.l HWIO_TX_UNIFIED_ENC_EUL_CODE_SEG_SIZE_BANK1_ADDR A:0x43810fc
y.create.l HWIO_TX_UNIFIED_ENC_EUL_TURBO_INTLV_PARAM0_BANK0_ADDR A:0x4381100
y.create.l HWIO_TX_UNIFIED_ENC_EUL_TURBO_INTLV_PARAM0_BANK1_ADDR A:0x4381104
y.create.l HWIO_TX_UNIFIED_ENC_EUL_TURBO_INTLV_PARAM1_BANK0_ADDR A:0x4381108
y.create.l HWIO_TX_UNIFIED_ENC_EUL_TURBO_INTLV_PARAM1_BANK1_ADDR A:0x438110c
y.create.l HWIO_TX_UNIFIED_ENC_OFFL_ENC_FRAME_ADDR A:0x4381110
y.create.l HWIO_TX_UNIFIED_EUL_ENC_TRIGGER_ADDR A:0x4381114
y.create.l HWIO_TX_UNIFIED_ENC_EUL_ENC_BANK_CFG_ADDR A:0x4381118
y.create.l HWIO_TX_1X_CH1_ENC_CTL_ADDR A:0x438111c
y.create.l HWIO_TX_1X_CH1_CRC_POLY_ADDR A:0x4381120
y.create.l HWIO_TX_1X_CH2_ENC_CTL_0_ADDR A:0x4381124
y.create.l HWIO_TX_1X_CH2_ENC_CTL_1_ADDR A:0x4381128
y.create.l HWIO_TX_1X_CH2_CRC_POLY_ADDR A:0x438112c
y.create.l HWIO_TX_1X_CH3_ENC_CTL_0_ADDR A:0x4381130
y.create.l HWIO_TX_1X_CH3_ENC_CTL_1_ADDR A:0x4381134
y.create.l HWIO_TX_1X_CH3_CRC_POLY_ADDR A:0x4381138
y.create.l HWIO_TX_DO_SCRAMB_INIT_0_ADDR A:0x438113c
y.create.l HWIO_TX_TDS_RM_EINI_ERUCCH_ADDR A:0x4381148
y.create.l HWIO_TX_TDS_RM_EMINUS_ERUCCH_ADDR A:0x438114c
y.create.l HWIO_TX_TDS_RM_EPLUS_ERUCCH_ADDR A:0x4381150
y.create.l HWIO_TX_TDS_CCTRCH_SI_ADDR A:0x4381154
y.create.l HWIO_TX_TDS_ERUCCH_ADDR_ADDR A:0x4381158
y.create.l HWIO_TX_TDS_CCTRCH_ADDR_ADDR A:0x438115c
y.create.l HWIO_TX_TDS_SLOT_DATA_NUM0_CCTRCH1_ADDR A:0x4381160
y.create.l HWIO_TX_TDS_SLOT_DATA_NUM1_CCTRCH1_ADDR A:0x4381164
y.create.l HWIO_TX_TDS_SLOT_DATA_NUM2_CCTRCH1_ADDR A:0x4381168
y.create.l HWIO_TX_TDS_SLOT_DATA_NUM0_CCTRCH2_ADDR A:0x438116c
y.create.l HWIO_TX_TDS_SLOT_DATA_NUM1_CCTRCH2_ADDR A:0x4381170
y.create.l HWIO_TX_TDS_SLOT_DATA_NUM2_CCTRCH2_ADDR A:0x4381174
y.create.l HWIO_TX_UNIFIED_ENC_EUL_RM_SYS_EINI_ADDR A:0x4381178
y.create.l HWIO_TX_UNIFIED_ENC_EUL_RM_SYS_EPLUS_EMINUS_ADDR A:0x438117c
y.create.l HWIO_TX_UNIFIED_ENC_EUL_RM_P1_EINI_ADDR A:0x4381180
y.create.l HWIO_TX_UNIFIED_ENC_EUL_RM_P1_EPLUS_ADDR A:0x4381184
y.create.l HWIO_TX_UNIFIED_ENC_EUL_RM_P1_EMINUS_ADDR A:0x4381188
y.create.l HWIO_TX_UNIFIED_ENC_EUL_RM_P2_EINI_ADDR A:0x438118c
y.create.l HWIO_TX_UNIFIED_ENC_EUL_RM_P2_EPLUS_EMINUS_ADDR A:0x4381190
y.create.l HWIO_TX_UNIFIED_ENC_EUL_RM_SYS_NUMBITS_ADDR A:0x4381194
y.create.l HWIO_TX_UNIFIED_ENC_EUL_RM_P1P2_NUMBITS_ADDR A:0x4381198
y.create.l HWIO_TX_TDS_EUL_NUMBITS_ADDR A:0x438119c
y.create.l HWIO_UMTS_TX_EUL_RM_RAM_BASE_ADDR_ADDR A:0x43811a0
y.create.l HWIO_TX_1X_CH1_PUNCT_PATN_1_ADDR A:0x43811a4
y.create.l HWIO_TX_1X_CH1_PUNCT_PATN_0_ADDR A:0x43811a8
y.create.l HWIO_TX_1X_CH2_PUNCT_PATN_1_ADDR A:0x43811ac
y.create.l HWIO_TX_1X_CH2_PUNCT_PATN_0_ADDR A:0x43811b0
y.create.l HWIO_TX_1X_CH3_PUNCT_PATN_1_ADDR A:0x43811b4
y.create.l HWIO_TX_1X_CH3_PUNCT_PATN_0_ADDR A:0x43811b8
y.create.l HWIO_TX_1X_LPN_BOZO_ADDR A:0x43811bc
y.create.l HWIO_TX_UNIFIED_PN_LD_ADDR A:0x43811c0
y.create.l HWIO_TX_UNIFIED_PN_MASK_LD_ADDR A:0x43811c4
y.create.l HWIO_TX_1X_I_PN_STATE_ADDR A:0x43811c8
y.create.l HWIO_TX_1X_Q_PN_STATE_ADDR A:0x43811cc
y.create.l HWIO_TX_1X_U_PN_MASK_0_ADDR A:0x43811d0
y.create.l HWIO_TX_1X_U_PN_MASK_1_ADDR A:0x43811d4
y.create.l HWIO_TX_1X_U_PN_STATE_0_ADDR A:0x43811d8
y.create.l HWIO_TX_1X_U_PN_STATE_1_ADDR A:0x43811dc
y.create.l HWIO_TX_DO_PN_STATE_0_ADDR A:0x43811e0
y.create.l HWIO_TX_DO_PN_STATE_1_ADDR A:0x43811e4
y.create.l HWIO_TX_DO_I_PN_MASK_0_C0_ADDR A:0x43811e8
y.create.l HWIO_TX_DO_I_PN_MASK_1_C0_ADDR A:0x43811f4
y.create.l HWIO_TX_DO_Q_PN_MASK_0_C0_ADDR A:0x4381200
y.create.l HWIO_TX_DO_Q_PN_MASK_1_C0_ADDR A:0x438120c
y.create.l HWIO_TX_DO_FOC_PN_CTL_C0_ADDR A:0x4381218
y.create.l HWIO_TX_DO_TRAFFIC_PN_CTL_ADDR A:0x4381224
y.create.l HWIO_TX_UMTS_SCR_CODE_INIT_ADDR A:0x4381228
y.create.l HWIO_TX_TDS_SCR_CODE_INIT_ADDR A:0x4381230
y.create.l HWIO_TX_1X_PICH_PCBIT_DATA_ADDR A:0x4381234
y.create.l HWIO_TX_1X_PICH_PCBIT_MASK_ADDR A:0x4381238
y.create.l HWIO_TX_DO_REV0_RRI_CTL_ADDR A:0x438123c
y.create.l HWIO_TX_DO_ACK_CTL_C0_ADDR A:0x4381240
y.create.l HWIO_TX_DO_DRC_CTL_C0_ADDR A:0x438124c
y.create.l HWIO_TX_DO_DSC_CTL_C0_ADDR A:0x4381258
y.create.l HWIO_TX_DO_REVAB_RRI_CTL_C0_ADDR A:0x4381264
y.create.l HWIO_TX_1X_FPC_BIT_ADDR A:0x4381270
y.create.l HWIO_TX_UMTS_PHY_CH_TYPE_ADDR A:0x4381274
y.create.l HWIO_TX_UMTS_RACH_CTL_ADDR A:0x4381278
y.create.l HWIO_TX_UMTS_RACH_OVSF_ADDR A:0x438127c
y.create.l HWIO_TX_UMTS_CTL_CH_DATA_ADDR A:0x4381280
y.create.l HWIO_TX_UMTS_SPARE_CH_DATA_ADDR A:0x4381284
y.create.l HWIO_TX_UMTS_SPARE_CH_CTL_ADDR A:0x4381288
y.create.l HWIO_TX_UNIFIED_SPARE_DATA_CH_CTL_0_ADDR A:0x438128c
y.create.l HWIO_TX_UNIFIED_SPARE_DATA_CH_CTL_1_ADDR A:0x4381290
y.create.l HWIO_TX_UNIFIED_SPARE_DATA_CH_FINE_CTL_0_ADDR A:0x4381294
y.create.l HWIO_TX_UNIFIED_SPARE_DATA_CH_FINE_CTL_1_ADDR A:0x4381298
y.create.l HWIO_TX_UMTS_DPDCH_CTL_ADDR A:0x438129c
y.create.l HWIO_TX_UMTS_HSDPCCH_CTL_ADDR A:0x43812a0
y.create.l HWIO_TX_UMTS_HSDPCCH_DATA_ADDR A:0x43812a4
y.create.l HWIO_TX_UMTS_EUL_NUMBITS_EDPDCH0_ADDR A:0x43812a8
y.create.l HWIO_TX_UMTS_EUL_NUMBITS_EDPDCH1_ADDR A:0x43812ac
y.create.l HWIO_TX_UMTS_EUL_NUMBITS_EDPDCH2_ADDR A:0x43812b0
y.create.l HWIO_TX_UMTS_EUL_NUMBITS_EDPDCH3_ADDR A:0x43812b4
y.create.l HWIO_TX_UMTS_EUL_EDPDCH_CONFIG_ADDR A:0x43812c8
y.create.l HWIO_TX_UMTS_EUL_EDPDCH_CTL0_ADDR A:0x43812cc
y.create.l HWIO_TX_UMTS_EUL_EDPDCH_CTL1_ADDR A:0x43812d0
y.create.l HWIO_TX_UMTS_EUL_EDPDCH_CTL2_ADDR A:0x43812d4
y.create.l HWIO_TX_UMTS_EUL_EDPDCH_CTL3_ADDR A:0x43812d8
y.create.l HWIO_TX_UMTS_EUL_EDPCCH_CTL_ADDR A:0x43812dc
y.create.l HWIO_TX_UMTS_EUL_EDPCCH_DATA_ADDR A:0x43812e0
y.create.l HWIO_TX_TDS_EUCCH_ADDR A:0x43812e4
y.create.l HWIO_TX_TDS_HSSICH0_ADDR A:0x43812e8
y.create.l HWIO_TX_TDS_HSSICH1_ADDR A:0x43812ec
y.create.l HWIO_TX_TDS_HSSICH2_ADDR A:0x43812f0
y.create.l HWIO_TX_TDS_SYNC_UL0_ADDR A:0x43812f4
y.create.l HWIO_TX_TDS_SYNC_UL1_ADDR A:0x43812f8
y.create.l HWIO_TX_TDS_SYNC_UL2_ADDR A:0x43812fc
y.create.l HWIO_TX_TDS_SYNC_UL3_ADDR A:0x4381300
y.create.l HWIO_TX_TDS_MIDAMBLE_SHIFT_ADDR A:0x4381304
y.create.l HWIO_TX_TDS_MIDAMBLE0_ADDR A:0x4381308
y.create.l HWIO_TX_TDS_MIDAMBLE1_ADDR A:0x438130c
y.create.l HWIO_TX_TDS_MIDAMBLE2_ADDR A:0x4381310
y.create.l HWIO_TX_TDS_MIDAMBLE3_ADDR A:0x4381314
y.create.l HWIO_TX_TDS_SLOT_CTL_PHY_CH0_ADDR A:0x4381318
y.create.l HWIO_TX_TDS_SLOT_CTL_PHY_CH1_ADDR A:0x438131c
y.create.l HWIO_TX_TDS_SS_PHY_CH0_ADDR A:0x4381320
y.create.l HWIO_TX_TDS_SS_PHY_CH1_ADDR A:0x4381324
y.create.l HWIO_TX_TDS_TFCI_PHY_CH0_ADDR A:0x4381328
y.create.l HWIO_TX_TDS_TFCI_PHY_CH1_ADDR A:0x438132c
y.create.l HWIO_TX_TDS_TPC_PHY_CH0_ADDR A:0x4381330
y.create.l HWIO_TX_TDS_TPC_PHY_CH1_ADDR A:0x4381334
y.create.l HWIO_TX_UNIFIED_NUM_ZEROS_FLUSH_ADDR A:0x4381338
y.create.l HWIO_TX_UNIFIED_FRAME_OFFSET_ADDR A:0x438133c
y.create.l HWIO_TX_UNIFIED_FRAME_OFF_LD_ADDR A:0x4381340
y.create.l HWIO_TX_UNIFIED_SAMPLE_CNT_INIT_VAL_ADDR A:0x4381344
y.create.l HWIO_TX_UNIFIED_SAMPLE_CNT_LD_ADDR A:0x4381348
y.create.l HWIO_TX_UNIFIED_SAMPLE_CNT_READ_ADDR A:0x438134c
y.create.l HWIO_TX_UNIFIED_SAMPLE_CNT_UPDATE_TIME_ADDR A:0x4381350
y.create.l HWIO_TX_UMTS_EUL_TTI_MODE_ADDR A:0x4381354
y.create.l HWIO_TX_UMTS_HSDPCCH_OFFSET_ADDR A:0x4381358
y.create.l HWIO_TX_UNIFIED_BETAP_GAIN_UPDATE_ADDR A:0x438135c
y.create.l HWIO_TX_UNIFIED_PA_RANGE_UPDATE_ADDR A:0x4381360
y.create.l HWIO_TX_UNIFIED_OFFL_EN_ADDR A:0x4381364
y.create.l HWIO_TX_UNIFIED_DTX_EN_ADDR A:0x4381368
y.create.l HWIO_TX_UNIFIED_ERAM_CTL_ADDR A:0x438136c
y.create.l HWIO_TX_TDS_EUL_RM_BANK_SEL_ADDR A:0x4381370
y.create.l HWIO_TX_UNIFIED_ENC_STATUS_ADDR A:0x4381374
y.create.l HWIO_TX_TDS_GUARD_PERIOD_ADDR A:0x4381378
y.create.l HWIO_TX_1X_DBR_MASK_READ_ADDR A:0x438137c
y.create.l HWIO_TX_TDS_NEW_SUBFRAME_FW_ADDR A:0x4381380
y.create.l HWIO_TX_1X_MISC_CTL_ADDR A:0x4381384
y.create.l HWIO_TX_UNIFIED_CARRIER_EN_ADDR A:0x4381388
y.create.l HWIO_TX_DO_GAIN_BANK_ADDR A:0x438138c
y.create.l HWIO_TX_UNIFIED_GAIN_0_ADDR A:0x4381390
y.create.l HWIO_TX_UNIFIED_GAIN_1_ADDR A:0x4381394
y.create.l HWIO_TX_UNIFIED_GAIN_2_ADDR A:0x4381398
y.create.l HWIO_TX_UNIFIED_GAIN_3_ADDR A:0x438139c
y.create.l HWIO_TX_UNIFIED_GAIN_4_ADDR A:0x43813a0
y.create.l HWIO_TX_UNIFIED_GAIN_5_ADDR A:0x43813a4
y.create.l HWIO_TX_C2K_BETAP_GAIN_C0_ADDR A:0x43813a8
y.create.l HWIO_TX_UNIFIED_ADVRET_CMD_ADDR A:0x43813b4
y.create.l HWIO_TX_UNIFIED_ADVRET_TYPE_ADDR A:0x43813b8
y.create.l HWIO_TX_1X_MOD_WCOVER_SEL_ADDR A:0x43813bc
y.create.l HWIO_TX_DO_CTL_C0_ADDR A:0x43813c0
y.create.l HWIO_TX_TDS_NUM_DATA_PHY_CH0_ADDR A:0x43813cc
y.create.l HWIO_TX_TDS_NUM_DATA_PHY_CH1_ADDR A:0x43813d0
y.create.l HWIO_TX_TDS_SPR_FACTOR_CTL_ADDR A:0x43813d4
y.create.l HWIO_TX_TDS_EUL_MOD_CTL_ADDR A:0x43813d8
y.create.l HWIO_TX_TDS_SLOT_IDX_ADDR A:0x43813dc
y.create.l HWIO_TX_UMTS_DCH_RACH_LAST_ADDR A:0x43813e0
y.create.l HWIO_TX_UNIFIED_PRED_CLIP_BYPASS_ADDR A:0x43813e4
y.create.l HWIO_TX_UNIFIED_PRED_CLIP_C0_ADDR A:0x43813e8
y.create.l HWIO_TX_UNIFIED_PRED_CLIP_GLOBAL_ADDR A:0x43813f4
y.create.l HWIO_TX_TDS_BBF_WINDOW_ADDR A:0x43813f8
y.create.l HWIO_TX_UNIFIED_PA_RANGE_ADDR A:0x43813fc
y.create.l HWIO_TX_UNIFIED_ROTANGLE_0_ADDR A:0x4381400
y.create.l HWIO_TX_UNIFIED_ROTANGLE_1_ADDR A:0x4381404
y.create.l HWIO_TX_UNIFIED_ROT_FREQ_STEP_C0_ADDR A:0x4381408
y.create.l HWIO_TX_UNIFIED_CRC_BYPASS_ADDR A:0x4381414
y.create.l HWIO_TX_UNIFIED_MEM_PTR_EN_ADDR A:0x4381418
y.create.l HWIO_TX_MEM_ERAM_ADDR_0_ADDR A:0x438145c
y.create.l HWIO_TX_MEM_ERAM_ADDR_1_ADDR A:0x4381460
y.create.l HWIO_TX_MEM_ERAM_ADDR_2_ADDR A:0x4381464
y.create.l HWIO_TX_MEM_ERAM_ADDR_3_ADDR A:0x4381468
y.create.l HWIO_TX_MEM_ERAM_ADDR_4_ADDR A:0x438146c
y.create.l HWIO_TX_MEM_ERAM_ADDR_5_ADDR A:0x4381470
y.create.l HWIO_TX_MEM_ERAM_ADDR_6_ADDR A:0x4381474
y.create.l HWIO_TX_MEM_ERAM_ADDR_7_ADDR A:0x4381478
y.create.l HWIO_TX_MEM_ERAM_ADDR_8_ADDR A:0x438147c
y.create.l HWIO_TX_MEM_ERAM_ADDR_9_ADDR A:0x4381480
y.create.l HWIO_TX_MEM_IRAM_ADDR_0_ADDR A:0x4381490
y.create.l HWIO_TX_MEM_IRAM_ADDR_1_ADDR A:0x4381494
y.create.l HWIO_TX_MEM_IRAM_ADDR_2_ADDR A:0x4381498
y.create.l HWIO_TX_MEM_IRAM_ADDR_3_ADDR A:0x438149c
y.create.l HWIO_TX_MEM_IRAM_ADDR_4_ADDR A:0x43814a0
y.create.l HWIO_TX_MEM_IRAM_ADDR_5_ADDR A:0x43814a4
y.create.l HWIO_TX_MEM_IRAM_ADDR_6_ADDR A:0x43814a8
y.create.l HWIO_TX_MEM_IRAM_ADDR_7_ADDR A:0x43814ac
y.create.l HWIO_TX_MEM_IRAM_ADDR_8_ADDR A:0x43814b0
y.create.l HWIO_TX_MEM_IRAM_ADDR_9_ADDR A:0x43814b4
y.create.l HWIO_TX_SUMTS_DECIMATE_ADDR A:0x43814c4
y.create.l HWIO_TX_UNIFIED_ENC_TRBLK_PARAM_TRCH0_ADDR A:0x4381800
y.create.l HWIO_TX_UNIFIED_ENC_TRBLK_PARAM_TRCH1_ADDR A:0x4381804
y.create.l HWIO_TX_UNIFIED_ENC_TRBLK_PARAM_TRCH2_ADDR A:0x4381808
y.create.l HWIO_TX_UNIFIED_ENC_TRBLK_PARAM_TRCH3_ADDR A:0x438180c
y.create.l HWIO_TX_UNIFIED_ENC_TRBLK_PARAM_TRCH4_ADDR A:0x4381810
y.create.l HWIO_TX_UNIFIED_ENC_TRBLK_PARAM_TRCH5_ADDR A:0x4381814
y.create.l HWIO_TX_UNIFIED_ENC_TRBLK_PARAM_TRCH6_ADDR A:0x4381818
y.create.l HWIO_TX_UNIFIED_ENC_TRBLK_PARAM_TRCH7_ADDR A:0x438181c
y.create.l HWIO_TX_UNIFIED_ENC_ERAMB_ADDR_TRCH0_ADDR A:0x4381820
y.create.l HWIO_TX_UNIFIED_ENC_ERAMB_ADDR_TRCH1_ADDR A:0x4381824
y.create.l HWIO_TX_UNIFIED_ENC_ERAMB_ADDR_TRCH2_ADDR A:0x4381828
y.create.l HWIO_TX_UNIFIED_ENC_ERAMB_ADDR_TRCH3_ADDR A:0x438182c
y.create.l HWIO_TX_UNIFIED_ENC_ERAMB_ADDR_TRCH4_ADDR A:0x4381830
y.create.l HWIO_TX_UNIFIED_ENC_ERAMB_ADDR_TRCH5_ADDR A:0x4381834
y.create.l HWIO_TX_UNIFIED_ENC_ERAMB_ADDR_TRCH6_ADDR A:0x4381838
y.create.l HWIO_TX_UNIFIED_ENC_ERAMB_ADDR_TRCH7_ADDR A:0x438183c
y.create.l HWIO_TX_UNIFIED_ENC_CODING_PARAM_TRCH0_ADDR A:0x4381900
y.create.l HWIO_TX_UNIFIED_ENC_CODING_PARAM_TRCH1_ADDR A:0x4381904
y.create.l HWIO_TX_UNIFIED_ENC_CODING_PARAM_TRCH2_ADDR A:0x4381908
y.create.l HWIO_TX_UNIFIED_ENC_CODING_PARAM_TRCH3_ADDR A:0x438190c
y.create.l HWIO_TX_UNIFIED_ENC_CODING_PARAM_TRCH4_ADDR A:0x4381910
y.create.l HWIO_TX_UNIFIED_ENC_CODING_PARAM_TRCH5_ADDR A:0x4381914
y.create.l HWIO_TX_UNIFIED_ENC_CODING_PARAM_TRCH6_ADDR A:0x4381918
y.create.l HWIO_TX_UNIFIED_ENC_CODING_PARAM_TRCH7_ADDR A:0x438191c
y.create.l HWIO_TX_UNIFIED_ENC_CODE_SEG_SIZE_TRCH0_ADDR A:0x4381920
y.create.l HWIO_TX_UNIFIED_ENC_CODE_SEG_SIZE_TRCH1_ADDR A:0x4381924
y.create.l HWIO_TX_UNIFIED_ENC_CODE_SEG_SIZE_TRCH2_ADDR A:0x4381928
y.create.l HWIO_TX_UNIFIED_ENC_CODE_SEG_SIZE_TRCH3_ADDR A:0x438192c
y.create.l HWIO_TX_UNIFIED_ENC_CODE_SEG_SIZE_TRCH4_ADDR A:0x4381930
y.create.l HWIO_TX_UNIFIED_ENC_CODE_SEG_SIZE_TRCH5_ADDR A:0x4381934
y.create.l HWIO_TX_UNIFIED_ENC_CODE_SEG_SIZE_TRCH6_ADDR A:0x4381938
y.create.l HWIO_TX_UNIFIED_ENC_CODE_SEG_SIZE_TRCH7_ADDR A:0x438193c
y.create.l HWIO_TX_UNIFIED_ENC_RM_EINI_TRCH0_ADDR A:0x4381940
y.create.l HWIO_TX_UNIFIED_ENC_RM_EINI_TRCH1_ADDR A:0x4381944
y.create.l HWIO_TX_UNIFIED_ENC_RM_EINI_TRCH2_ADDR A:0x4381948
y.create.l HWIO_TX_UNIFIED_ENC_RM_EINI_TRCH3_ADDR A:0x438194c
y.create.l HWIO_TX_UNIFIED_ENC_RM_EINI_TRCH4_ADDR A:0x4381950
y.create.l HWIO_TX_UNIFIED_ENC_RM_EINI_TRCH5_ADDR A:0x4381954
y.create.l HWIO_TX_UNIFIED_ENC_RM_EINI_TRCH6_ADDR A:0x4381958
y.create.l HWIO_TX_UNIFIED_ENC_RM_EINI_TRCH7_ADDR A:0x438195c
y.create.l HWIO_TX_UNIFIED_ENC_RM_EMINUS_TRCH0_ADDR A:0x4381960
y.create.l HWIO_TX_UNIFIED_ENC_RM_EMINUS_TRCH1_ADDR A:0x4381964
y.create.l HWIO_TX_UNIFIED_ENC_RM_EMINUS_TRCH2_ADDR A:0x4381968
y.create.l HWIO_TX_UNIFIED_ENC_RM_EMINUS_TRCH3_ADDR A:0x438196c
y.create.l HWIO_TX_UNIFIED_ENC_RM_EMINUS_TRCH4_ADDR A:0x4381970
y.create.l HWIO_TX_UNIFIED_ENC_RM_EMINUS_TRCH5_ADDR A:0x4381974
y.create.l HWIO_TX_UNIFIED_ENC_RM_EMINUS_TRCH6_ADDR A:0x4381978
y.create.l HWIO_TX_UNIFIED_ENC_RM_EMINUS_TRCH7_ADDR A:0x438197c
y.create.l HWIO_TX_UNIFIED_ENC_RM_EPLUS_TRCH0_ADDR A:0x4381980
y.create.l HWIO_TX_UNIFIED_ENC_RM_EPLUS_TRCH1_ADDR A:0x4381984
y.create.l HWIO_TX_UNIFIED_ENC_RM_EPLUS_TRCH2_ADDR A:0x4381988
y.create.l HWIO_TX_UNIFIED_ENC_RM_EPLUS_TRCH3_ADDR A:0x438198c
y.create.l HWIO_TX_UNIFIED_ENC_RM_EPLUS_TRCH4_ADDR A:0x4381990
y.create.l HWIO_TX_UNIFIED_ENC_RM_EPLUS_TRCH5_ADDR A:0x4381994
y.create.l HWIO_TX_UNIFIED_ENC_RM_EPLUS_TRCH6_ADDR A:0x4381998
y.create.l HWIO_TX_UNIFIED_ENC_RM_EPLUS_TRCH7_ADDR A:0x438199c
y.create.l HWIO_TX_UNIFIED_ENC_TURBO_INTLV_PARAM0_TRCH0_ADDR A:0x43819a0
y.create.l HWIO_TX_UNIFIED_ENC_TURBO_INTLV_PARAM0_TRCH1_ADDR A:0x43819a4
y.create.l HWIO_TX_UNIFIED_ENC_TURBO_INTLV_PARAM0_TRCH2_ADDR A:0x43819a8
y.create.l HWIO_TX_UNIFIED_ENC_TURBO_INTLV_PARAM0_TRCH3_ADDR A:0x43819ac
y.create.l HWIO_TX_UNIFIED_ENC_TURBO_INTLV_PARAM0_TRCH4_ADDR A:0x43819b0
y.create.l HWIO_TX_UNIFIED_ENC_TURBO_INTLV_PARAM0_TRCH5_ADDR A:0x43819b4
y.create.l HWIO_TX_UNIFIED_ENC_TURBO_INTLV_PARAM0_TRCH6_ADDR A:0x43819b8
y.create.l HWIO_TX_UNIFIED_ENC_TURBO_INTLV_PARAM0_TRCH7_ADDR A:0x43819bc
y.create.l HWIO_TX_UNIFIED_ENC_TURBO_INTLV_PARAM1_TRCH0_ADDR A:0x43819c0
y.create.l HWIO_TX_UNIFIED_ENC_TURBO_INTLV_PARAM1_TRCH1_ADDR A:0x43819c4
y.create.l HWIO_TX_UNIFIED_ENC_TURBO_INTLV_PARAM1_TRCH2_ADDR A:0x43819c8
y.create.l HWIO_TX_UNIFIED_ENC_TURBO_INTLV_PARAM1_TRCH3_ADDR A:0x43819cc
y.create.l HWIO_TX_UNIFIED_ENC_TURBO_INTLV_PARAM1_TRCH4_ADDR A:0x43819d0
y.create.l HWIO_TX_UNIFIED_ENC_TURBO_INTLV_PARAM1_TRCH5_ADDR A:0x43819d4
y.create.l HWIO_TX_UNIFIED_ENC_TURBO_INTLV_PARAM1_TRCH6_ADDR A:0x43819d8
y.create.l HWIO_TX_UNIFIED_ENC_TURBO_INTLV_PARAM1_TRCH7_ADDR A:0x43819dc
y.create.l HWIO_TX_UNIFIED_ENC_ERAM_DATA_INCRACC_0_ADDR A:0x4381a00
y.create.l HWIO_TX_UNIFIED_ENC_ERAM_DATA_INCRACC_1_ADDR A:0x4381a04
y.create.l HWIO_TX_UNIFIED_ENC_ERAM_DATA_INCRACC_2_ADDR A:0x4381a08
y.create.l HWIO_TX_UNIFIED_ENC_ERAM_DATA_INCRACC_3_ADDR A:0x4381a0c
y.create.l HWIO_TX_UNIFIED_ENC_TRCH_MUX_ORDER_CCTRCH1_ADDR A:0x4381a20
y.create.l HWIO_TX_TDS_TRCH_MUX_ORDER_CCTRCH2_ADDR A:0x4381a40
y.create.l HWIO_TX_TDS_DPCH0_LAST_SLOT0_BANK0_ADDR A:0x4381b00
y.create.l HWIO_TX_TDS_DPCH0_LAST_SLOT1_BANK0_ADDR A:0x4381b04
y.create.l HWIO_TX_TDS_DPCH0_LAST_SLOT2_BANK0_ADDR A:0x4381b08
y.create.l HWIO_TX_TDS_DPCH0_LAST_SLOT3_BANK0_ADDR A:0x4381b0c
y.create.l HWIO_TX_TDS_DPCH0_LAST_SLOT4_BANK0_ADDR A:0x4381b10
y.create.l HWIO_TX_TDS_DPCH0_SLOT0_BANK0_ADDR A:0x4381b40
y.create.l HWIO_TX_TDS_DPCH0_SLOT1_BANK0_ADDR A:0x4381b44
y.create.l HWIO_TX_TDS_DPCH0_SLOT2_BANK0_ADDR A:0x4381b48
y.create.l HWIO_TX_TDS_DPCH0_SLOT3_BANK0_ADDR A:0x4381b4c
y.create.l HWIO_TX_TDS_DPCH0_SLOT4_BANK0_ADDR A:0x4381b50
y.create.l HWIO_TX_TDS_DPCH0_SLOT5_BANK0_ADDR A:0x4381b54
y.create.l HWIO_TX_TDS_DPCH0_SLOT6_BANK0_ADDR A:0x4381b58
y.create.l HWIO_TX_TDS_DPCH0_SLOT7_BANK0_ADDR A:0x4381b5c
y.create.l HWIO_TX_TDS_DPCH0_SLOT8_BANK0_ADDR A:0x4381b60
y.create.l HWIO_TX_TDS_DPCH0_SLOT9_BANK0_ADDR A:0x4381b64
y.create.l HWIO_TX_TDS_DPCH1_LAST_SLOT0_BANK0_ADDR A:0x4381b80
y.create.l HWIO_TX_TDS_DPCH1_LAST_SLOT1_BANK0_ADDR A:0x4381b84
y.create.l HWIO_TX_TDS_DPCH1_LAST_SLOT2_BANK0_ADDR A:0x4381b88
y.create.l HWIO_TX_TDS_DPCH1_LAST_SLOT3_BANK0_ADDR A:0x4381b8c
y.create.l HWIO_TX_TDS_DPCH1_LAST_SLOT4_BANK0_ADDR A:0x4381b90
y.create.l HWIO_TX_TDS_DPCH1_SLOT0_BANK0_ADDR A:0x4381bc0
y.create.l HWIO_TX_TDS_DPCH1_SLOT1_BANK0_ADDR A:0x4381bc4
y.create.l HWIO_TX_TDS_DPCH1_SLOT2_BANK0_ADDR A:0x4381bc8
y.create.l HWIO_TX_TDS_DPCH1_SLOT3_BANK0_ADDR A:0x4381bcc
y.create.l HWIO_TX_TDS_DPCH1_SLOT4_BANK0_ADDR A:0x4381bd0
y.create.l HWIO_TX_TDS_DPCH1_SLOT5_BANK0_ADDR A:0x4381bd4
y.create.l HWIO_TX_TDS_DPCH1_SLOT6_BANK0_ADDR A:0x4381bd8
y.create.l HWIO_TX_TDS_DPCH1_SLOT7_BANK0_ADDR A:0x4381bdc
y.create.l HWIO_TX_TDS_DPCH1_SLOT8_BANK0_ADDR A:0x4381be0
y.create.l HWIO_TX_TDS_DPCH1_SLOT9_BANK0_ADDR A:0x4381be4
y.create.l HWIO_TX_TDS_EPUCH_LAST_BANK0_ADDR A:0x4381c00
y.create.l HWIO_TX_TDS_EPUCH_SLOT0_BANK0_ADDR A:0x4381c20
y.create.l HWIO_TX_TDS_EPUCH_SLOT1_BANK0_ADDR A:0x4381c24
y.create.l HWIO_TX_TDS_EPUCH_SLOT2_BANK0_ADDR A:0x4381c28
y.create.l HWIO_TX_TDS_EPUCH_SLOT3_BANK0_ADDR A:0x4381c2c
y.create.l HWIO_TX_TDS_EPUCH_SLOT4_BANK0_ADDR A:0x4381c30
y.create.l HWIO_TX_TDS_ERUCCH_LAST_BANK0_ADDR A:0x4381c40
y.create.l HWIO_TX_TDS_ERUCCH_SUBFRAME0_BANK0_ADDR A:0x4381c60
y.create.l HWIO_TX_TDS_ERUCCH_SUBFRAME1_BANK0_ADDR A:0x4381c64
y.create.l HWIO_TX_TDS_DPCH0_LAST_SLOT0_BANK1_ADDR A:0x4381ca0
y.create.l HWIO_TX_TDS_DPCH0_LAST_SLOT1_BANK1_ADDR A:0x4381ca4
y.create.l HWIO_TX_TDS_DPCH0_LAST_SLOT2_BANK1_ADDR A:0x4381ca8
y.create.l HWIO_TX_TDS_DPCH0_LAST_SLOT3_BANK1_ADDR A:0x4381cac
y.create.l HWIO_TX_TDS_DPCH0_LAST_SLOT4_BANK1_ADDR A:0x4381cb0
y.create.l HWIO_TX_TDS_DPCH0_SLOT0_BANK1_ADDR A:0x4381cc0
y.create.l HWIO_TX_TDS_DPCH0_SLOT1_BANK1_ADDR A:0x4381cc4
y.create.l HWIO_TX_TDS_DPCH0_SLOT2_BANK1_ADDR A:0x4381cc8
y.create.l HWIO_TX_TDS_DPCH0_SLOT3_BANK1_ADDR A:0x4381ccc
y.create.l HWIO_TX_TDS_DPCH0_SLOT4_BANK1_ADDR A:0x4381cd0
y.create.l HWIO_TX_TDS_DPCH0_SLOT5_BANK1_ADDR A:0x4381cd4
y.create.l HWIO_TX_TDS_DPCH0_SLOT6_BANK1_ADDR A:0x4381cd8
y.create.l HWIO_TX_TDS_DPCH0_SLOT7_BANK1_ADDR A:0x4381cdc
y.create.l HWIO_TX_TDS_DPCH0_SLOT8_BANK1_ADDR A:0x4381ce0
y.create.l HWIO_TX_TDS_DPCH0_SLOT9_BANK1_ADDR A:0x4381ce4
y.create.l HWIO_TX_TDS_DPCH1_LAST_SLOT0_BANK1_ADDR A:0x4381d00
y.create.l HWIO_TX_TDS_DPCH1_LAST_SLOT1_BANK1_ADDR A:0x4381d04
y.create.l HWIO_TX_TDS_DPCH1_LAST_SLOT2_BANK1_ADDR A:0x4381d08
y.create.l HWIO_TX_TDS_DPCH1_LAST_SLOT3_BANK1_ADDR A:0x4381d0c
y.create.l HWIO_TX_TDS_DPCH1_LAST_SLOT4_BANK1_ADDR A:0x4381d10
y.create.l HWIO_TX_TDS_DPCH1_SLOT0_BANK1_ADDR A:0x4381d40
y.create.l HWIO_TX_TDS_DPCH1_SLOT1_BANK1_ADDR A:0x4381d44
y.create.l HWIO_TX_TDS_DPCH1_SLOT2_BANK1_ADDR A:0x4381d48
y.create.l HWIO_TX_TDS_DPCH1_SLOT3_BANK1_ADDR A:0x4381d4c
y.create.l HWIO_TX_TDS_DPCH1_SLOT4_BANK1_ADDR A:0x4381d50
y.create.l HWIO_TX_TDS_DPCH1_SLOT5_BANK1_ADDR A:0x4381d54
y.create.l HWIO_TX_TDS_DPCH1_SLOT6_BANK1_ADDR A:0x4381d58
y.create.l HWIO_TX_TDS_DPCH1_SLOT7_BANK1_ADDR A:0x4381d5c
y.create.l HWIO_TX_TDS_DPCH1_SLOT8_BANK1_ADDR A:0x4381d60
y.create.l HWIO_TX_TDS_DPCH1_SLOT9_BANK1_ADDR A:0x4381d64
y.create.l HWIO_TX_TDS_EPUCH_LAST_BANK1_ADDR A:0x4381d80
y.create.l HWIO_TX_TDS_EPUCH_SLOT0_BANK1_ADDR A:0x4381da0
y.create.l HWIO_TX_TDS_EPUCH_SLOT1_BANK1_ADDR A:0x4381da4
y.create.l HWIO_TX_TDS_EPUCH_SLOT2_BANK1_ADDR A:0x4381da8
y.create.l HWIO_TX_TDS_EPUCH_SLOT3_BANK1_ADDR A:0x4381dac
y.create.l HWIO_TX_TDS_EPUCH_SLOT4_BANK1_ADDR A:0x4381db0
y.create.l HWIO_TX_TDS_ERUCCH_LAST_BANK1_ADDR A:0x4381dc0
y.create.l HWIO_TX_TDS_ERUCCH_SUBFRAME0_BANK1_ADDR A:0x4381de0
y.create.l HWIO_TX_TDS_ERUCCH_SUBFRAME1_BANK1_ADDR A:0x4381de4
y.create.l HWIO_TX_DO_GAIN_0_1_C0_BANK0_ADDR A:0x4381e00
y.create.l HWIO_TX_DO_GAIN_2_3_C0_BANK0_ADDR A:0x4381e0c
y.create.l HWIO_TX_DO_GAIN_4_5_C0_BANK0_ADDR A:0x4381e18
y.create.l HWIO_TX_DO_GAIN_6_7_C0_BANK0_ADDR A:0x4381e24
y.create.l HWIO_TX_DO_GAIN_8_9_C0_BANK0_ADDR A:0x4381e30
y.create.l HWIO_TX_DO_GAIN_0_1_C0_BANK1_ADDR A:0x4381f00
y.create.l HWIO_TX_DO_GAIN_2_3_C0_BANK1_ADDR A:0x4381f0c
y.create.l HWIO_TX_DO_GAIN_4_5_C0_BANK1_ADDR A:0x4381f18
y.create.l HWIO_TX_DO_GAIN_6_7_C0_BANK1_ADDR A:0x4381f24
y.create.l HWIO_TX_DO_GAIN_8_9_C0_BANK1_ADDR A:0x4381f30
y.create.l HWIO_TX_MEM_START_ADDR A:0x4382000
y.create.l HWIO_TX_RDR0_CFG0_ADDR A:0x4383000
y.create.l HWIO_TX_RDR1_CFG0_ADDR A:0x4383008
y.create.l HWIO_TX_RDR0_CFG1_ADDR A:0x4383004
y.create.l HWIO_TX_RDR1_CFG1_ADDR A:0x438300c
y.create.l HWIO_TX_RDR0_XFER_CTL_ADDR A:0x4383010
y.create.l HWIO_TX_RDR1_XFER_CTL_ADDR A:0x4383014
y.create.l HWIO_TX_WRTR_CFG0_ADDR A:0x4383018
y.create.l HWIO_TX_WRTR_CFG1_ADDR A:0x438301c
y.create.l HWIO_TX_WRTR_XFER_CTL_ADDR A:0x4383020
y.create.l HWIO_TX_BRDG_CTL_ADDR A:0x4383024
y.create.l HWIO_TX_BRDG_STATUS_ADDR A:0x4383028
y.create.l HWIO_TX_BRDG_CLEAR_ADDR A:0x438302c
y.create.l HWIO_TX_BRDG_ARB_PRI_ADDR A:0x4383030
y.create.l HWIO_TX_RDR0_VBUF_ADDR_ADDR A:0x4383034
y.create.l HWIO_TX_RDR1_VBUF_ADDR_ADDR A:0x4383038
y.create.l HWIO_TX_WRTR_VBUF_ADDR_ADDR A:0x438303c
y.create.l HWIO_TX_BRDG_AXI_PRI_ADDR A:0x4383040
y.create.l HWIO_TXR_IQ_DAC_A0_ADDR A:0x4385000
y.create.l HWIO_TXR_STR_CTRL_A0_ADDR A:0x4385008
y.create.l HWIO_TXR_PDA_CTRL_A0_ADDR A:0x438500c
y.create.l HWIO_TXR_PDA_WD_UPDATE_CTRL_A0_ADDR A:0x4385010
y.create.l HWIO_TXR_PDA_CTRL_WD_OFFSET_A0_ADDR A:0x4385014
y.create.l HWIO_TXR_PDA_OFFSET_CMD_A0_ADDR A:0x4385018
y.create.l HWIO_TXR_PPDSM_CTL_A0_ADDR A:0x438501c
y.create.l HWIO_TXR_PPDSM_OVERRIDE_VAL_A0_ADDR A:0x4385020
y.create.l HWIO_TXR_PPDSM_OVERRIDE_REP_A0_ADDR A:0x4385024
y.create.l HWIO_TXR_FIFO_PTR_DIFF_A_A0_ADDR A:0x4385028
y.create.l HWIO_TXR_FIFO_PTR_DIFF_B_A0_ADDR A:0x438502c
y.create.l HWIO_TXR_FIFO_STATUS_A_A0_ADDR A:0x4385030
y.create.l HWIO_TXR_FIFO_STATUS_B_A0_ADDR A:0x4385034
y.create.l HWIO_TXR_FIFO_CMD_A0_ADDR A:0x4385038
y.create.l HWIO_TXR_FIFO_CTRL_A0_ADDR A:0x438503c
y.create.l HWIO_TXR_STREAM_IF_CTRL_A0_ADDR A:0x4385040
y.create.l HWIO_TXR_FMT_CONV_CTL_A0_ADDR A:0x4385050
y.create.l HWIO_TXR_TEST_BUS_IN_IQ_SWAP_A0_ADDR A:0x4385054
y.create.l HWIO_TXR_TEST_BUS_OUT_IQ_SWAP_A0_ADDR A:0x4385058
y.create.l HWIO_TXR_IQ_DAC_CURRENT_A0_ADDR A:0x438505c
y.create.l HWIO_TXR_STR_CTRL_CURRENT_A0_ADDR A:0x4385060
y.create.l HWIO_TXR_PDA_CTRL_CURRENT_A0_ADDR A:0x4385064
y.create.l HWIO_TXR_PDA_WD_UPDATE_CTRL_CURRENT_A0_ADDR A:0x4385068
y.create.l HWIO_TXR_PDA_CTRL_WD_OFFSET_CURRENT_A0_ADDR A:0x438506c
y.create.l HWIO_TXR_PDA_OFFSET_CMD_CURRENT_A0_ADDR A:0x4385070
y.create.l HWIO_TXR_PPDSM_CTL_CURRENT_A0_ADDR A:0x4385074
y.create.l HWIO_TXR_PPDSM_OVERRIDE_VAL_CURRENT_A0_ADDR A:0x4385078
y.create.l HWIO_TXR_PPDSM_OVERRIDE_REP_CURRENT_A0_ADDR A:0x438507c
y.create.l HWIO_TXR_STREAM_IF_CTRL_CURRENT_A0_ADDR A:0x4385080
y.create.l HWIO_TXR_FMT_CONV_CTL_CURRENT_A0_ADDR A:0x4385084
y.create.l HWIO_TXC_DP_CFG_A1_ADDR A:0x4386004
y.create.l HWIO_TXC_DP_ENV_SCALE_VAL_A1_ADDR A:0x4386010
y.create.l HWIO_TXC_DP_ENV_SCALE_VAL_SET2_A1_ADDR A:0x4386014
y.create.l HWIO_TXC_DP_RAMP_ARM_A1_ADDR A:0x4386024
y.create.l HWIO_TXC_DP_RAMP_START_TIME_A1_ADDR A:0x4386028
y.create.l HWIO_TXC_DP_RAMP_SLOT_A_CFG_A1_ADDR A:0x4386038
y.create.l HWIO_TXC_DP_RAMP_SLOT_B_CFG_A1_ADDR A:0x438603c
y.create.l HWIO_TXC_DP_RAMP_GAP_A1_ADDR A:0x4386040
y.create.l HWIO_TXC_DP_RAMP_SLOT_A_CFG_ACT_A1_ADDR A:0x4386044
y.create.l HWIO_TXC_DP_RAMP_SLOT_B_CFG_ACT_A1_ADDR A:0x4386048
y.create.l HWIO_TXC_DP_RAMP_GAP_ACT_A1_ADDR A:0x438604c
y.create.l HWIO_TXC_DP_PHASE_OVR_VAL_A1_ADDR A:0x4386080
y.create.l HWIO_TXC_PP_PHASE_OVR_VAL_A1_ADDR A:0x4386084
y.create.l HWIO_TXC_DP_ENV_OVR_VAL_A1_ADDR A:0x4386088
y.create.l HWIO_TXC_EP_ENV_OVR_VAL_A1_ADDR A:0x438608c
y.create.l HWIO_TXC_EP_ENV_OVR_VAL_SET2_A1_ADDR A:0x4386090
y.create.l HWIO_TXC_DP_ROT_PHASE_INC_A1_ADDR A:0x43860a0
y.create.l HWIO_TXC_DP_ROT_PHASE_INC_SET2_A1_ADDR A:0x43860a4
y.create.l HWIO_TXC_DP_ROT_PHASE_INIT_A1_ADDR A:0x43860a8
y.create.l HWIO_TXC_DP_ROT_PHASE_INIT_SET2_A1_ADDR A:0x43860ac
y.create.l HWIO_TXC_DP_ROT_PHASE_SHIFT_A1_ADDR A:0x43860b0
y.create.l HWIO_TXC_DP_ROT_PHASE_SHIFT_SET2_A1_ADDR A:0x43860b4
y.create.l HWIO_TXC_DM1_CFG_A1_ADDR A:0x4386100
y.create.l HWIO_TXC_EP_GAIN_A1_ADDR A:0x4386160
y.create.l HWIO_TXC_EP_GAIN_SET2_A1_ADDR A:0x4386164
y.create.l HWIO_TXC_EP_DCOC_A1_ADDR A:0x4386170
y.create.l HWIO_TXC_EP_DCOC_SET2_A1_ADDR A:0x4386174
y.create.l HWIO_TXC_EP_DM2_FINE_TAU_A1_ADDR A:0x4386178
y.create.l HWIO_TXC_EP_DM3_FRAC_TAU_A1_ADDR A:0x438617c
y.create.l HWIO_TXC_PP_GAIN_A1_ADDR A:0x4386180
y.create.l HWIO_TXC_PP_SPILL_A1_ADDR A:0x4386190
y.create.l HWIO_TXC_TIMESTAMP_T1_A1_ADDR A:0x43861a0
y.create.l HWIO_TXC_TIMESTAMP_T2_A1_ADDR A:0x43861a8
y.create.l HWIO_TXC_TIMESTAMP_REUSE_A1_ADDR A:0x43861b0
y.create.l HWIO_TXC_SAMPLE_COUNT_A1_ADDR A:0x43861b4
y.create.l HWIO_TXC_SAMPLE_COUNT_CTL_A1_ADDR A:0x43861b8
y.create.l HWIO_TXC_REF_ARM_A1_ADDR A:0x43861c0
y.create.l HWIO_TXC_REF_DWN_FACTOR_A1_ADDR A:0x43861c4
y.create.l HWIO_TXC_REF_NUM_SAMPLES_A1_ADDR A:0x43861c8
y.create.l HWIO_TXC_REF_START_TIME_A1_ADDR A:0x43861cc
y.create.l HWIO_TXC_REF_STATUS_A1_ADDR A:0x43861d0
y.create.l HWIO_TXC_REF_PEAK_POWER_A1_ADDR A:0x43861d4
y.create.l HWIO_TXC_REF_RMS_POWER_M_A1_ADDR A:0x43861d8
y.create.l HWIO_TXC_REF_RMS_POWER_L_A1_ADDR A:0x43861dc
y.create.l HWIO_TXC_REF_MODE_A1_ADDR A:0x43861e0
y.create.l HWIO_TXC_REF_I_GAIN_VAL_A1_ADDR A:0x43861e4
y.create.l HWIO_TXC_REF_Q_GAIN_VAL_A1_ADDR A:0x43861e8
y.create.l HWIO_TXC_REF_POWERCALC_OR_LOG_A1_ADDR A:0x43861ec
y.create.l HWIO_TXC_TESTBUS_SELECT_A1_ADDR A:0x43861f0
y.create.l HWIO_TXC_TEST_BUS_IN_IQ_SWAP_A1_ADDR A:0x43861f4
y.create.l HWIO_TXC_TEST_BUS_OUT_IQ_SWAP_A1_ADDR A:0x43861f8
y.create.l HWIO_TXC_AMAM_PENDING_A1_ADDR A:0x4386220
y.create.l HWIO_TXC_AMPM_PENDING_A1_ADDR A:0x4386224
y.create.l HWIO_TXC_AMAM_PENDING_SET2_A1_ADDR A:0x4386230
y.create.l HWIO_TXC_AMPM_PENDING_SET2_A1_ADDR A:0x4386234
y.create.l HWIO_TXC_AMAM_ACTIVE_A1_ADDR A:0x4386240
y.create.l HWIO_TXC_AMPM_ACTIVE_A1_ADDR A:0x4386244
y.create.l HWIO_TXC_RAMP_ACTIVE_A1_ADDR A:0x438624c
y.create.l HWIO_TXC_REF_POWER_SUM_I_A1_ADDR A:0x43862e0
y.create.l HWIO_TXC_REF_POWER_SUM_Q_A1_ADDR A:0x43862e4
y.create.l HWIO_TXC_REF_POWER_SUM_IQ_M_A1_ADDR A:0x43862e8
y.create.l HWIO_TXC_REF_POWER_SUM_IQ_L_A1_ADDR A:0x43862ec
y.create.l HWIO_TXC_REF_POWER_SUM_QQ_M_A1_ADDR A:0x43862f0
y.create.l HWIO_TXC_REF_POWER_SUM_QQ_L_A1_ADDR A:0x43862f4
y.create.l HWIO_TXC_DP_CFG_LATCHED_A1_ADDR A:0x4386300
y.create.l HWIO_TXC_DP_ENV_SCALE_VAL_LATCHED_A1_ADDR A:0x4386304
y.create.l HWIO_TXC_DP_PHASE_OVR_VAL_LATCHED_A1_ADDR A:0x4386308
y.create.l HWIO_TXC_PP_PHASE_OVR_VAL_LATCHED_A1_ADDR A:0x438630c
y.create.l HWIO_TXC_DP_ENV_OVR_VAL_LATCHED_A1_ADDR A:0x4386310
y.create.l HWIO_TXC_EP_ENV_OVR_VAL_LATCHED_A1_ADDR A:0x4386314
y.create.l HWIO_TXC_DP_ROT_PHASE_INC_LATCHED_A1_ADDR A:0x4386318
y.create.l HWIO_TXC_DP_ROT_PHASE_INIT_LATCHED_A1_ADDR A:0x438631c
y.create.l HWIO_TXC_DP_ROT_PHASE_SHIFT_LATCHED_A1_ADDR A:0x4386320
y.create.l HWIO_TXC_DM1_CFG_LATCHED_A1_ADDR A:0x4386338
y.create.l HWIO_TXC_EP_GAIN_LATCHED_A1_ADDR A:0x438633c
y.create.l HWIO_TXC_EP_DCOC_LATCHED_A1_ADDR A:0x4386344
y.create.l HWIO_TXC_EP_DM2_FINE_TAU_LATCHED_A1_ADDR A:0x4386348
y.create.l HWIO_TXC_EP_DM3_FRAC_TAU_LATCHED_A1_ADDR A:0x438634c
y.create.l HWIO_TXC_PP_GAIN_LATCHED_A1_ADDR A:0x4386350
y.create.l HWIO_TXC_PP_SPILL_LATCHED_A1_ADDR A:0x4386354
y.create.l HWIO_TXR_IQ_DAC_A1_ADDR A:0x4387000
y.create.l HWIO_TXR_STR_CTRL_A1_ADDR A:0x4387008
y.create.l HWIO_TXR_PDA_CTRL_A1_ADDR A:0x438700c
y.create.l HWIO_TXR_PDA_WD_UPDATE_CTRL_A1_ADDR A:0x4387010
y.create.l HWIO_TXR_PDA_CTRL_WD_OFFSET_A1_ADDR A:0x4387014
y.create.l HWIO_TXR_PDA_OFFSET_CMD_A1_ADDR A:0x4387018
y.create.l HWIO_TXR_PPDSM_CTL_A1_ADDR A:0x438701c
y.create.l HWIO_TXR_PPDSM_OVERRIDE_VAL_A1_ADDR A:0x4387020
y.create.l HWIO_TXR_PPDSM_OVERRIDE_REP_A1_ADDR A:0x4387024
y.create.l HWIO_TXR_FIFO_PTR_DIFF_A_A1_ADDR A:0x4387028
y.create.l HWIO_TXR_FIFO_PTR_DIFF_B_A1_ADDR A:0x438702c
y.create.l HWIO_TXR_FIFO_STATUS_A_A1_ADDR A:0x4387030
y.create.l HWIO_TXR_FIFO_STATUS_B_A1_ADDR A:0x4387034
y.create.l HWIO_TXR_FIFO_CMD_A1_ADDR A:0x4387038
y.create.l HWIO_TXR_FIFO_CTRL_A1_ADDR A:0x438703c
y.create.l HWIO_TXR_STREAM_IF_CTRL_A1_ADDR A:0x4387040
y.create.l HWIO_TXR_FMT_CONV_CTL_A1_ADDR A:0x4387050
y.create.l HWIO_TXR_TEST_BUS_IN_IQ_SWAP_A1_ADDR A:0x4387054
y.create.l HWIO_TXR_TEST_BUS_OUT_IQ_SWAP_A1_ADDR A:0x4387058
y.create.l HWIO_TXR_IQ_DAC_CURRENT_A1_ADDR A:0x438705c
y.create.l HWIO_TXR_STR_CTRL_CURRENT_A1_ADDR A:0x4387060
y.create.l HWIO_TXR_PDA_CTRL_CURRENT_A1_ADDR A:0x4387064
y.create.l HWIO_TXR_PDA_WD_UPDATE_CTRL_CURRENT_A1_ADDR A:0x4387068
y.create.l HWIO_TXR_PDA_CTRL_WD_OFFSET_CURRENT_A1_ADDR A:0x438706c
y.create.l HWIO_TXR_PDA_OFFSET_CMD_CURRENT_A1_ADDR A:0x4387070
y.create.l HWIO_TXR_PPDSM_CTL_CURRENT_A1_ADDR A:0x4387074
y.create.l HWIO_TXR_PPDSM_OVERRIDE_VAL_CURRENT_A1_ADDR A:0x4387078
y.create.l HWIO_TXR_PPDSM_OVERRIDE_REP_CURRENT_A1_ADDR A:0x438707c
y.create.l HWIO_TXR_STREAM_IF_CTRL_CURRENT_A1_ADDR A:0x4387080
y.create.l HWIO_TXR_FMT_CONV_CTL_CURRENT_A1_ADDR A:0x4387084
y.create.l HWIO_TXC_TECH_SEL_A0_ADDR A:0x4384000
y.create.l HWIO_TXC_DP_CFG_A0_ADDR A:0x4384004
y.create.l HWIO_TXC_DP_CFG_2_A0_ADDR A:0x4384008
y.create.l HWIO_TXC_DP_ENV_SCALE_VAL_A0_ADDR A:0x4384010
y.create.l HWIO_TXC_DP_ENV_SCALE_VAL_SET2_A0_ADDR A:0x4384014
y.create.l HWIO_TXC_DP_ENV_SCALE_VAL_IMM_A0_ADDR A:0x4384018
y.create.l HWIO_TXC_DP_RAMP_ARM_A0_ADDR A:0x4384024
y.create.l HWIO_TXC_DP_RAMP_START_TIME_A0_ADDR A:0x4384028
y.create.l HWIO_TXC_DP_RAMP_SLOT_A_CFG_A0_ADDR A:0x4384038
y.create.l HWIO_TXC_DP_RAMP_SLOT_B_CFG_A0_ADDR A:0x438403c
y.create.l HWIO_TXC_DP_RAMP_GAP_A0_ADDR A:0x4384040
y.create.l HWIO_TXC_DP_RAMP_SLOT_A_CFG_ACT_A0_ADDR A:0x4384044
y.create.l HWIO_TXC_DP_RAMP_SLOT_B_CFG_ACT_A0_ADDR A:0x4384048
y.create.l HWIO_TXC_DP_RAMP_GAP_ACT_A0_ADDR A:0x438404c
y.create.l HWIO_TXC_DP_PHASE_OVR_VAL_A0_ADDR A:0x4384080
y.create.l HWIO_TXC_PP_PHASE_OVR_VAL_A0_ADDR A:0x4384084
y.create.l HWIO_TXC_DP_ENV_OVR_VAL_A0_ADDR A:0x4384088
y.create.l HWIO_TXC_EP_ENV_OVR_VAL_A0_ADDR A:0x438408c
y.create.l HWIO_TXC_EP_ENV_OVR_VAL_SET2_A0_ADDR A:0x4384090
y.create.l HWIO_TXC_DP_ROT_PHASE_INC_A0_ADDR A:0x43840a0
y.create.l HWIO_TXC_DP_ROT_PHASE_INC_SET2_A0_ADDR A:0x43840a4
y.create.l HWIO_TXC_DP_ROT_PHASE_INIT_A0_ADDR A:0x43840a8
y.create.l HWIO_TXC_DP_ROT_PHASE_INIT_SET2_A0_ADDR A:0x43840ac
y.create.l HWIO_TXC_DP_ROT_PHASE_SHIFT_A0_ADDR A:0x43840b0
y.create.l HWIO_TXC_DP_ROT_PHASE_SHIFT_SET2_A0_ADDR A:0x43840b4
y.create.l HWIO_TXC_DP_IQ_GAIN_A0_ADDR A:0x43840b8
y.create.l HWIO_TXC_DP_IQ_GAIN_SET2_A0_ADDR A:0x43840bc
y.create.l HWIO_TXC_DP_IQMC_A0_ADDR A:0x43840d0
y.create.l HWIO_TXC_DP_IQMC_SET2_A0_ADDR A:0x43840d4
y.create.l HWIO_TXC_DP_PEQ1_A0_ADDR A:0x43840d8
y.create.l HWIO_TXC_DP_PEQ1_SET2_A0_ADDR A:0x43840dc
y.create.l HWIO_TXC_DP_PEQ2_A0_ADDR A:0x43840f0
y.create.l HWIO_TXC_DP_PEQ2_SET2_A0_ADDR A:0x43840f4
y.create.l HWIO_TXC_DP_DCOC_A0_ADDR A:0x43840f8
y.create.l HWIO_TXC_DP_DCOC_SET2_A0_ADDR A:0x43840fc
y.create.l HWIO_TXC_DM1_CFG_A0_ADDR A:0x4384100
y.create.l HWIO_TXC_DP_IQ_GAIN_IMM_A0_ADDR A:0x4384104
y.create.l HWIO_TXC_DP_IQMC_IMM_A0_ADDR A:0x4384108
y.create.l HWIO_TXC_DP_DCOC_IMM_A0_ADDR A:0x438410c
y.create.l HWIO_TXC_DP_PEQ1_Q_A0_ADDR A:0x4384110
y.create.l HWIO_TXC_DP_PEQ1_Q_SET2_A0_ADDR A:0x4384114
y.create.l HWIO_TXC_EP_GAIN_A0_ADDR A:0x4384160
y.create.l HWIO_TXC_EP_GAIN_SET2_A0_ADDR A:0x4384164
y.create.l HWIO_TXC_EP_PEQ1_A0_ADDR A:0x4384168
y.create.l HWIO_TXC_EP_PEQ1_SET2_A0_ADDR A:0x438416c
y.create.l HWIO_TXC_EP_DCOC_A0_ADDR A:0x4384170
y.create.l HWIO_TXC_EP_DCOC_SET2_A0_ADDR A:0x4384174
y.create.l HWIO_TXC_EP_DM2_FINE_TAU_A0_ADDR A:0x4384178
y.create.l HWIO_TXC_EP_DM3_FRAC_TAU_A0_ADDR A:0x438417c
y.create.l HWIO_TXC_PP_GAIN_A0_ADDR A:0x4384180
y.create.l HWIO_TXC_PP_SPILL_A0_ADDR A:0x4384190
y.create.l HWIO_TXC_EP_PEQ2_A0_ADDR A:0x4384198
y.create.l HWIO_TXC_TIMESTAMP_T1_A0_ADDR A:0x43841a0
y.create.l HWIO_TXC_TIMESTAMP_T2_A0_ADDR A:0x43841a8
y.create.l HWIO_TXC_TIMESTAMP_REUSE_A0_ADDR A:0x43841b0
y.create.l HWIO_TXC_SAMPLE_COUNT_A0_ADDR A:0x43841b4
y.create.l HWIO_TXC_SAMPLE_COUNT_CTL_A0_ADDR A:0x43841b8
y.create.l HWIO_TXC_REF_ARM_A0_ADDR A:0x43841c0
y.create.l HWIO_TXC_REF_DWN_FACTOR_A0_ADDR A:0x43841c4
y.create.l HWIO_TXC_REF_NUM_SAMPLES_A0_ADDR A:0x43841c8
y.create.l HWIO_TXC_REF_START_TIME_A0_ADDR A:0x43841cc
y.create.l HWIO_TXC_REF_STATUS_A0_ADDR A:0x43841d0
y.create.l HWIO_TXC_REF_PEAK_POWER_A0_ADDR A:0x43841d4
y.create.l HWIO_TXC_REF_RMS_POWER_M_A0_ADDR A:0x43841d8
y.create.l HWIO_TXC_REF_RMS_POWER_L_A0_ADDR A:0x43841dc
y.create.l HWIO_TXC_REF_MODE_A0_ADDR A:0x43841e0
y.create.l HWIO_TXC_REF_I_GAIN_VAL_A0_ADDR A:0x43841e4
y.create.l HWIO_TXC_REF_Q_GAIN_VAL_A0_ADDR A:0x43841e8
y.create.l HWIO_TXC_REF_POWERCALC_OR_LOG_A0_ADDR A:0x43841ec
y.create.l HWIO_TXC_TESTBUS_SELECT_A0_ADDR A:0x43841f0
y.create.l HWIO_TXC_TEST_BUS_IN_IQ_SWAP_A0_ADDR A:0x43841f4
y.create.l HWIO_TXC_TEST_BUS_OUT_IQ_SWAP_A0_ADDR A:0x43841f8
y.create.l HWIO_TXC_AMAM_PENDING_A0_ADDR A:0x4384220
y.create.l HWIO_TXC_AMPM_PENDING_A0_ADDR A:0x4384224
y.create.l HWIO_TXC_AMAM_PENDING_SET2_A0_ADDR A:0x4384230
y.create.l HWIO_TXC_AMPM_PENDING_SET2_A0_ADDR A:0x4384234
y.create.l HWIO_TXC_AMAM_ACTIVE_A0_ADDR A:0x4384240
y.create.l HWIO_TXC_AMPM_ACTIVE_A0_ADDR A:0x4384244
y.create.l HWIO_TXC_RAMP_ACTIVE_A0_ADDR A:0x438424c
y.create.l HWIO_TXC_REF_POWER_SUM_I_A0_ADDR A:0x43842e0
y.create.l HWIO_TXC_REF_POWER_SUM_Q_A0_ADDR A:0x43842e4
y.create.l HWIO_TXC_REF_POWER_SUM_IQ_M_A0_ADDR A:0x43842e8
y.create.l HWIO_TXC_REF_POWER_SUM_IQ_L_A0_ADDR A:0x43842ec
y.create.l HWIO_TXC_REF_POWER_SUM_QQ_M_A0_ADDR A:0x43842f0
y.create.l HWIO_TXC_REF_POWER_SUM_QQ_L_A0_ADDR A:0x43842f4
y.create.l HWIO_TXC_DP_CFG_LATCHED_A0_ADDR A:0x4384300
y.create.l HWIO_TXC_DP_ENV_SCALE_VAL_LATCHED_A0_ADDR A:0x4384304
y.create.l HWIO_TXC_DP_PHASE_OVR_VAL_LATCHED_A0_ADDR A:0x4384308
y.create.l HWIO_TXC_PP_PHASE_OVR_VAL_LATCHED_A0_ADDR A:0x438430c
y.create.l HWIO_TXC_DP_ENV_OVR_VAL_LATCHED_A0_ADDR A:0x4384310
y.create.l HWIO_TXC_EP_ENV_OVR_VAL_LATCHED_A0_ADDR A:0x4384314
y.create.l HWIO_TXC_DP_ROT_PHASE_INC_LATCHED_A0_ADDR A:0x4384318
y.create.l HWIO_TXC_DP_ROT_PHASE_INIT_LATCHED_A0_ADDR A:0x438431c
y.create.l HWIO_TXC_DP_ROT_PHASE_SHIFT_LATCHED_A0_ADDR A:0x4384320
y.create.l HWIO_TXC_DP_IQ_GAIN_LATCHED_A0_ADDR A:0x4384324
y.create.l HWIO_TXC_DP_IQMC_LATCHED_A0_ADDR A:0x4384328
y.create.l HWIO_TXC_DP_PEQ1_LATCHED_A0_ADDR A:0x438432c
y.create.l HWIO_TXC_DP_PEQ2_LATCHED_A0_ADDR A:0x4384330
y.create.l HWIO_TXC_DP_DCOC_LATCHED_A0_ADDR A:0x4384334
y.create.l HWIO_TXC_DM1_CFG_LATCHED_A0_ADDR A:0x4384338
y.create.l HWIO_TXC_EP_GAIN_LATCHED_A0_ADDR A:0x438433c
y.create.l HWIO_TXC_EP_PEQ1_LATCHED_A0_ADDR A:0x4384340
y.create.l HWIO_TXC_EP_DCOC_LATCHED_A0_ADDR A:0x4384344
y.create.l HWIO_TXC_EP_DM2_FINE_TAU_LATCHED_A0_ADDR A:0x4384348
y.create.l HWIO_TXC_EP_DM3_FRAC_TAU_LATCHED_A0_ADDR A:0x438434c
y.create.l HWIO_TXC_PP_GAIN_LATCHED_A0_ADDR A:0x4384350
y.create.l HWIO_TXC_PP_SPILL_LATCHED_A0_ADDR A:0x4384354
y.create.l HWIO_TXC_EP_PEQ2_LATCHED_A0_ADDR A:0x4384358
y.create.l HWIO_TXC_DP_CFG_2_LATCHED_A0_ADDR A:0x438435c
y.create.l HWIO_TXC_DP_PEQ1_Q_LATCHED_A0_ADDR A:0x4384360
y.create.l HWIO_TXC_MEM_BANK0_ADDR0_ADDR A:0x4388000
y.create.l HWIO_TXC_MEM_BANK0_ADDR1_ADDR A:0x4388004
y.create.l HWIO_TXC_MEM_BANK0_ADDR2_ADDR A:0x4388008
y.create.l HWIO_TXC_MEM_BANK0_ADDR3_ADDR A:0x438800c
y.create.l HWIO_TXC_MEM_BANK1_ADDR0_ADDR A:0x4388400
y.create.l HWIO_TXC_MEM_BANK1_ADDR1_ADDR A:0x4388404
y.create.l HWIO_TXC_MEM_BANK1_ADDR2_ADDR A:0x4388408
y.create.l HWIO_TXC_MEM_BANK1_ADDR3_ADDR A:0x438840c
y.create.l HWIO_TXC_MEM_BANK2_ADDR0_ADDR A:0x4388800
y.create.l HWIO_TXC_MEM_BANK2_ADDR1_ADDR A:0x4388804
y.create.l HWIO_TXC_MEM_BANK2_ADDR2_ADDR A:0x4388808
y.create.l HWIO_TXC_MEM_BANK2_ADDR3_ADDR A:0x438880c
y.create.l HWIO_TXC_MEM_BANK3_ADDR0_ADDR A:0x4388c00
y.create.l HWIO_TXC_MEM_BANK3_ADDR1_ADDR A:0x4388c04
y.create.l HWIO_TXC_MEM_BANK3_ADDR2_ADDR A:0x4388c08
y.create.l HWIO_TXC_MEM_BANK3_ADDR3_ADDR A:0x4388c0c
y.create.l HWIO_TXC_MEM_BANK4_ADDR0_ADDR A:0x4389000
y.create.l HWIO_TXC_MEM_BANK4_ADDR1_ADDR A:0x4389004
y.create.l HWIO_TXC_MEM_BANK4_ADDR2_ADDR A:0x4389008
y.create.l HWIO_TXC_MEM_BANK4_ADDR3_ADDR A:0x438900c
y.create.l HWIO_TXC_MEM_BANK5_ADDR0_ADDR A:0x4389400
y.create.l HWIO_TXC_MEM_BANK5_ADDR1_ADDR A:0x4389404
y.create.l HWIO_TXC_MEM_BANK5_ADDR2_ADDR A:0x4389408
y.create.l HWIO_TXC_MEM_BANK5_ADDR3_ADDR A:0x438940c
y.create.l HWIO_O_TX_TEST_MODE_ADDR A:0x438a000
y.create.l HWIO_O_TX_CLK_CTL_ADDR A:0x438a004
y.create.l HWIO_O_TX_SW_CLK_CTL_ADDR A:0x438a008
y.create.l HWIO_O_TX_CLK_STATUS_REG_ADDR A:0x438a00c
y.create.l HWIO_O_TX_ENCODER_STATUS_ADDR A:0x438a010
y.create.l HWIO_O_TX_HW_IDLE_ADDR A:0x438a014
y.create.l HWIO_O_TX_BUS_TIMEOUT_ADDR A:0x438a018
y.create.l HWIO_O_TX_WMORE_INT_STATUS_ADDR A:0x438a01c
y.create.l HWIO_O_TX_WMORE_INT_CLEAR_ADDR A:0x438a020
y.create.l HWIO_O_TX_WMORE_TX_PWRDWN_ADDR A:0x438a024
y.create.l HWIO_O_TX_L0_DEC_ACK_BITS_ADDR A:0x438a028
y.create.l HWIO_O_TX_L1_DEC_ACK_BITS_ADDR A:0x438a02c
y.create.l HWIO_O_TX_WMORE_CLIP_THR1_ADDR A:0x438a030
y.create.l HWIO_O_TX_WMORE_CLIP_THR2_ADDR A:0x438a034
y.create.l HWIO_O_TX_WMORE_TS2_ADDR A:0x438a038
y.create.l HWIO_O_TX_WMORE_TS1_ADDR A:0x438a03c
y.create.l HWIO_O_TX_WMORE_CLIP_ENABLE_ADDR A:0x438a040
y.create.l HWIO_O_TX_WMORE_NOTCH_ENABLE_ADDR A:0x438a044
y.create.l HWIO_O_TX_WMORE_NOTCH_ALPHA_I_ADDR A:0x438a048
y.create.l HWIO_O_TX_WMORE_NOTCH_ALPHA_Q_ADDR A:0x438a04c
y.create.l HWIO_O_TX_WMORE_NOTCH_BETA_ADDR A:0x438a050
y.create.l HWIO_O_TX_WMORE_NOTCH_TS1_ADDR A:0x438a054
y.create.l HWIO_O_TX_WMORE_IFFT_SIZE_ADDR A:0x438a058
y.create.l HWIO_O_TX_WMORE_STATUS_WORD0_ADDR A:0x438a200
y.create.l HWIO_TX_LTE_WMORE_WORD0_ADDR A:0x438a300
y.create.l HWIO_TX_LTE_WMORE_WORD1_ADDR A:0x438a304
y.create.l HWIO_TX_LTE_WMORE_WORD2_ADDR A:0x438a308
y.create.l HWIO_TX_LTE_WMORE_WORD3_ADDR A:0x438a30c
y.create.l HWIO_TX_LTE_WMORE_WORD4_ADDR A:0x438a310
y.create.l HWIO_TX_LTE_WMORE_WORD5_ADDR A:0x438a314
y.create.l HWIO_TX_LTE_WMORE_WORD6_ADDR A:0x438a318
y.create.l HWIO_TX_LTE_WMORE_WORD7_ADDR A:0x438a31c
y.create.l HWIO_TX_LTE_WMORE_UPPTS_WORD0_ADDR A:0x438a400
y.create.l HWIO_TX_LTE_WMORE_UPPTS_WORD1_ADDR A:0x438a404
y.create.l HWIO_TX_LTE_WMORE_UPPTS_WORD2_ADDR A:0x438a408
y.create.l HWIO_TX_LTE_WMORE_UPPTS_WORD3_ADDR A:0x438a40c
y.create.l HWIO_TX_LTE_WMORE_PRACH_WORD0_ADDR A:0x438a500
y.create.l HWIO_TX_LTE_WMORE_PRACH_WORD1_ADDR A:0x438a504
y.create.l HWIO_TX_LTE_WMORE_PRACH_WORD2_ADDR A:0x438a508
y.create.l HWIO_O_TX_ENC_STATUS_WORD0_ADDR A:0x438a600
y.create.l HWIO_TX_LTE_PUSCH_ENC_WORD0_ADDR A:0x438a700
y.create.l HWIO_TX_LTE_PUSCH_ENC_WORD1_ADDR A:0x438a704
y.create.l HWIO_TX_LTE_PUSCH_ENC_WORD2_ADDR A:0x438a708
y.create.l HWIO_TX_LTE_PUSCH_ENC_WORD3_ADDR A:0x438a70c
y.create.l HWIO_TX_LTE_PUSCH_ENC_WORD4_ADDR A:0x438a710
y.create.l HWIO_O_TX_MOD_STATUS_WORD0_ADDR A:0x438a800
y.create.l HWIO_TX_LTE_PUSCH_MOD_WORD0_ADDR A:0x438a900
y.create.l HWIO_TX_LTE_PUSCH_MOD_WORD1_ADDR A:0x438a904
y.create.l HWIO_TX_LTE_PUSCH_MOD_WORD2_ADDR A:0x438a908
y.create.l HWIO_TX_LTE_PUSCH_MOD_WORD3_ADDR A:0x438a90c
y.create.l HWIO_TX_LTE_PUSCH_MOD_WORD4_ADDR A:0x438a910
y.create.l HWIO_TX_LTE_PUSCH_MOD_WORD5_ADDR A:0x438a914
y.create.l HWIO_TX_LTE_PUSCH_MOD_WORD6_ADDR A:0x438a918
y.create.l HWIO_TX_LTE_PUSCH_MOD_WORD7_ADDR A:0x438a91c
y.create.l HWIO_TX_LTE_PUSCH_MOD_WORD8_ADDR A:0x438a920
y.create.l HWIO_TX_LTE_PUSCH_MOD_WORD9_ADDR A:0x438a924
y.create.l HWIO_TX_LTE_PUSCH_MOD_WORD10_ADDR A:0x438a928
y.create.l HWIO_TX_LTE_PUSCH_MOD_WORD11_ADDR A:0x438a92c
y.create.l HWIO_TX_LTE_PUSCH_MOD_WORD12_ADDR A:0x438a930
y.create.l HWIO_TX_LTE_PUSCH_MOD_WORD13_ADDR A:0x438a934
y.create.l HWIO_TX_LTE_PUSCH_MOD_WORD14_ADDR A:0x438a938
y.create.l HWIO_TX_LTE_PUSCH_MOD_WORD15_ADDR A:0x438a93c
y.create.l HWIO_TX_LTE_PUSCH_MOD_WORD16_ADDR A:0x438a940
y.create.l HWIO_TX_LTE_PUSCH_MOD_WORD17_ADDR A:0x438a944
y.create.l HWIO_TX_LTE_PUSCH_MOD_WORD18_ADDR A:0x438a948
y.create.l HWIO_TX_LTE_PUSCH_MOD_WORD19_ADDR A:0x438a94c
y.create.l HWIO_TX_LTE_PUSCH_MOD_WORD20_ADDR A:0x438a950
y.create.l HWIO_TX_LTE_PUSCH_MOD_WORD21_ADDR A:0x438a954
y.create.l HWIO_TX_LTE_PUCCH_MOD_WORD0_ADDR A:0x438aa00
y.create.l HWIO_TX_LTE_PUCCH_MOD_WORD1_ADDR A:0x438aa04
y.create.l HWIO_TX_LTE_PUCCH_MOD_WORD2_ADDR A:0x438aa08
y.create.l HWIO_TX_LTE_PUCCH_MOD_WORD3_ADDR A:0x438aa0c
y.create.l HWIO_TX_LTE_PUCCH_MOD_WORD4_ADDR A:0x438aa10
y.create.l HWIO_TX_LTE_PUCCH_MOD_WORD5_ADDR A:0x438aa14
y.create.l HWIO_TX_LTE_PUCCH_MOD_WORD6_ADDR A:0x438aa18
y.create.l HWIO_TX_LTE_PUCCH_MOD_WORD7_ADDR A:0x438aa1c
y.create.l HWIO_TX_LTE_PUCCH_MOD_WORD8_ADDR A:0x438aa20
y.create.l HWIO_TX_LTE_PUCCH_MOD_WORD9_ADDR A:0x438aa24
y.create.l HWIO_TX_LTE_PUCCH_MOD_WORD10_ADDR A:0x438aa28
y.create.l HWIO_TX_LTE_PUCCH_MOD_WORD11_ADDR A:0x438aa2c
y.create.l HWIO_TX_LTE_PUCCH_MOD_WORD12_ADDR A:0x438aa30
y.create.l HWIO_TX_LTE_PUCCH_MOD_WORD13_ADDR A:0x438aa34
y.create.l HWIO_TX_LTE_PRACH_MOD_WORD0_ADDR A:0x438ab00
y.create.l HWIO_TX_LTE_PRACH_MOD_WORD1_ADDR A:0x438ab04
y.create.l HWIO_TX_LTE_PRACH_MOD_WORD2_ADDR A:0x438ab08
y.create.l HWIO_TX_LTE_PRACH_MOD_WORD3_ADDR A:0x438ab0c
y.create.l HWIO_TX_LTE_PRACH_MOD_WORD4_ADDR A:0x438ab10
y.create.l HWIO_TX_LTE_PRACH_MOD_WORD5_ADDR A:0x438ab14
y.create.l HWIO_TX_LTE_UPPTS_MOD_WORD0_ADDR A:0x438ac00
y.create.l HWIO_TX_LTE_UPPTS_MOD_WORD1_ADDR A:0x438ac04
y.create.l HWIO_TX_LTE_UPPTS_MOD_WORD2_ADDR A:0x438ac08
y.create.l HWIO_TX_LTE_UPPTS_MOD_WORD3_ADDR A:0x438ac0c
y.create.l HWIO_TX_LTE_UPPTS_MOD_WORD4_ADDR A:0x438ac10
y.create.l HWIO_TX_LTE_UPPTS_MOD_WORD5_ADDR A:0x438ac14
y.create.l HWIO_TX_LTE_UPPTS_MOD_WORD6_ADDR A:0x438ac18
y.create.l HWIO_TX_LTE_UPPTS_MOD_WORD7_ADDR A:0x438ac1c
y.create.l HWIO_TX_LTE_UPPTS_MOD_WORD8_ADDR A:0x438ac20
y.create.l HWIO_TX_LTE_UPPTS_MOD_WORD9_ADDR A:0x438ac24
y.create.l HWIO_TX_LTE_PUSCH_MOD_ACK_WORD0_ADDR A:0x438ad00
y.create.l HWIO_TX_LTE_PUCCH_MOD_ACK_WORD0_ADDR A:0x438ae00
y.create.l HWIO_RXFE_ENABLE_ADDR A:0x4360000
y.create.l HWIO_RXFE_ADC0_LOGIC_CFG_ADDR A:0x4360004
y.create.l HWIO_RXFE_ADC1_LOGIC_CFG_ADDR A:0x4360008
y.create.l HWIO_RXFE_ADC2_LOGIC_CFG_ADDR A:0x436000c
y.create.l HWIO_RXFE_ADC3_LOGIC_CFG_ADDR A:0x4360010
y.create.l HWIO_RXFE_WB0_ADCMUX_CFG_ADDR A:0x4360018
y.create.l HWIO_RXFE_WB1_ADCMUX_CFG_ADDR A:0x436001c
y.create.l HWIO_RXFE_WB2_ADCMUX_CFG_ADDR A:0x4360020
y.create.l HWIO_RXFE_WB3_ADCMUX_CFG_ADDR A:0x4360024
y.create.l HWIO_RXFE_NB0_WBMUX_CFG_ADDR A:0x436002c
y.create.l HWIO_RXFE_NB1_WBMUX_CFG_ADDR A:0x4360030
y.create.l HWIO_RXFE_NB2_WBMUX_CFG_ADDR A:0x4360034
y.create.l HWIO_RXFE_NB3_WBMUX_CFG_ADDR A:0x4360038
y.create.l HWIO_RXFE_NB4_WBMUX_CFG_ADDR A:0x436003c
y.create.l HWIO_RXFE_NB5_WBMUX_CFG_ADDR A:0x4360040
y.create.l HWIO_RXFE_TOP_STATUS_ADDR A:0x436004c
y.create.l HWIO_RXFE_RFIF_UPDATE_CMD_ADDR A:0x4360050
y.create.l HWIO_RXFE_CMNNOTCH_FILT0_CFG0_ADDR A:0x4360054
y.create.l HWIO_RXFE_CMNNOTCH_FILT0_CFG1_ADDR A:0x4360058
y.create.l HWIO_RXFE_CMNNOTCH_FILT1_CFG0_ADDR A:0x436005c
y.create.l HWIO_RXFE_CMNNOTCH_FILT1_CFG1_ADDR A:0x4360060
y.create.l HWIO_RXFE_CMNNOTCH_FILT2_CFG0_ADDR A:0x4360064
y.create.l HWIO_RXFE_CMNNOTCH_FILT2_CFG1_ADDR A:0x4360068
y.create.l HWIO_RXFE_CMNNOTCH_FILT3_CFG0_ADDR A:0x436006c
y.create.l HWIO_RXFE_CMNNOTCH_FILT3_CFG1_ADDR A:0x4360070
y.create.l HWIO_RXFE_CMNNOTCH_FILT01_CFG_ADDR A:0x4360074
y.create.l HWIO_RXFE_CMNNOTCH_FILT23_CFG_ADDR A:0x4360078
y.create.l HWIO_RXFE_ACI_FILT0_CFG_ADDR A:0x436007c
y.create.l HWIO_RXFE_ACI_FILT1_CFG_ADDR A:0x4360080
y.create.l HWIO_RXFE_TOP_SPARE_REG_ADDR A:0x4360084
y.create.l HWIO_RXFE_DBG_ENABLES_ADDR A:0x4360090
y.create.l HWIO_RXFE_DBG_PROBE_CTL_ADDR A:0x4360094
y.create.l HWIO_RXFE_DBG_CMD_ADDR A:0x4360098
y.create.l HWIO_RXFE_PBS_CFG_ADDR A:0x436009c
y.create.l HWIO_RXFE_ADC_TEST1_REG_ADC0_ADDR A:0x4362000
y.create.l HWIO_RXFE_ADC_TEST2_REG_ADC0_ADDR A:0x4362004
y.create.l HWIO_RXFE_ADC_TEST3_REG_ADC0_ADDR A:0x4362008
y.create.l HWIO_RXFE_ADC_CONFIG1_REG_ADC0_ADDR A:0x436200c
y.create.l HWIO_RXFE_ADC_CONFIG2_REG_ADC0_ADDR A:0x4362010
y.create.l HWIO_RXFE_ADC_CONTROL_REG_ADC0_ADDR A:0x4362014
y.create.l HWIO_RXFE_ADC_TEST1_REG_ADC1_ADDR A:0x4362100
y.create.l HWIO_RXFE_ADC_TEST2_REG_ADC1_ADDR A:0x4362104
y.create.l HWIO_RXFE_ADC_TEST3_REG_ADC1_ADDR A:0x4362108
y.create.l HWIO_RXFE_ADC_CONFIG1_REG_ADC1_ADDR A:0x436210c
y.create.l HWIO_RXFE_ADC_CONFIG2_REG_ADC1_ADDR A:0x4362110
y.create.l HWIO_RXFE_ADC_CONTROL_REG_ADC1_ADDR A:0x4362114
y.create.l HWIO_RXFE_ADC_TEST1_REG_ADC2_ADDR A:0x4362200
y.create.l HWIO_RXFE_ADC_TEST2_REG_ADC2_ADDR A:0x4362204
y.create.l HWIO_RXFE_ADC_TEST3_REG_ADC2_ADDR A:0x4362208
y.create.l HWIO_RXFE_ADC_CONFIG1_REG_ADC2_ADDR A:0x436220c
y.create.l HWIO_RXFE_ADC_CONFIG2_REG_ADC2_ADDR A:0x4362210
y.create.l HWIO_RXFE_ADC_CONTROL_REG_ADC2_ADDR A:0x4362214
y.create.l HWIO_RXFE_ADC_TEST1_REG_ADC3_ADDR A:0x4362300
y.create.l HWIO_RXFE_ADC_TEST2_REG_ADC3_ADDR A:0x4362304
y.create.l HWIO_RXFE_ADC_TEST3_REG_ADC3_ADDR A:0x4362308
y.create.l HWIO_RXFE_ADC_CONFIG1_REG_ADC3_ADDR A:0x436230c
y.create.l HWIO_RXFE_ADC_CONFIG2_REG_ADC3_ADDR A:0x4362310
y.create.l HWIO_RXFE_ADC_CONTROL_REG_ADC3_ADDR A:0x4362314
y.create.l HWIO_RXFE_WB_TOP_CTL_WB0_ADDR A:0x4364000
y.create.l HWIO_RXFE_WB_TOP_CMD_WB0_ADDR A:0x4364004
y.create.l HWIO_RXFE_WB_TOP_STATUS_WB0_ADDR A:0x4364008
y.create.l HWIO_RXFE_WB_STOPGATE_ACTION_SAMPLE_WB0_ADDR A:0x436400c
y.create.l HWIO_RXFE_WB_TIMINGCTL_STATUS_WB0_ADDR A:0x4364010
y.create.l HWIO_RXFE_WB_MISC_CFG_WB0_ADDR A:0x4364014
y.create.l HWIO_RXFE_WB_WBPWR_CFG_WB0_ADDR A:0x4364018
y.create.l HWIO_RXFE_WB_WBPWR_CMD_WB0_ADDR A:0x436401c
y.create.l HWIO_RXFE_WB_WBPWR_START_ACTION_SAMPLE_WB0_ADDR A:0x4364020
y.create.l HWIO_RXFE_WB_WBPWR_START_MASK_WB0_ADDR A:0x4364024
y.create.l HWIO_RXFE_WB_WBPWR_STOP_ACTION_SAMPLE_WB0_ADDR A:0x4364028
y.create.l HWIO_RXFE_WB_WBPWR_FINAL_ACC_WB0_ADDR A:0x436402c
y.create.l HWIO_RXFE_WB_WBPWR_CURR_ACC_WB0_ADDR A:0x4364030
y.create.l HWIO_RXFE_WB_WBPWR_MAX_ACC_WB0_ADDR A:0x4364034
y.create.l HWIO_RXFE_WB_WBDC_CFG_WB0_ADDR A:0x4364038
y.create.l HWIO_RXFE_WB_WBDC_CMD_WB0_ADDR A:0x436403c
y.create.l HWIO_RXFE_WB_WBDC_START_ACTION_SAMPLE_WB0_ADDR A:0x4364040
y.create.l HWIO_RXFE_WB_WBDC_STOP_ACTION_SAMPLE_WB0_ADDR A:0x4364044
y.create.l HWIO_RXFE_WB_WBDC_UPDATE_ACTION_SAMPLE_WB0_ADDR A:0x4364048
y.create.l HWIO_RXFE_WB_WBDC_UPDATE_DELAY_WB0_ADDR A:0x436404c
y.create.l HWIO_RXFE_WB_WBDC_OVRD_I_WB0_ADDR A:0x4364050
y.create.l HWIO_RXFE_WB_WBDC_OVRD_Q_WB0_ADDR A:0x4364054
y.create.l HWIO_RXFE_WB_WBDC_EST1_CURR_I_WB0_ADDR A:0x4364058
y.create.l HWIO_RXFE_WB_WBDC_EST1_CURR_Q_WB0_ADDR A:0x436405c
y.create.l HWIO_RXFE_WB_WBDC_EST1_PREV_I_WB0_ADDR A:0x4364060
y.create.l HWIO_RXFE_WB_WBDC_EST1_PREV_Q_WB0_ADDR A:0x4364064
y.create.l HWIO_RXFE_WB_WBDC_EST1_LOAD_I_WB0_ADDR A:0x4364068
y.create.l HWIO_RXFE_WB_WBDC_EST1_LOAD_Q_WB0_ADDR A:0x436406c
y.create.l HWIO_RXFE_WB_WBDC_EST2_CURR_I_WB0_ADDR A:0x4364070
y.create.l HWIO_RXFE_WB_WBDC_EST2_CURR_Q_WB0_ADDR A:0x4364074
y.create.l HWIO_RXFE_WB_WBDC_EST2_PREV_I_WB0_ADDR A:0x4364078
y.create.l HWIO_RXFE_WB_WBDC_EST2_PREV_Q_WB0_ADDR A:0x436407c
y.create.l HWIO_RXFE_WB_WBDC_EST2_LOAD_I_WB0_ADDR A:0x4364080
y.create.l HWIO_RXFE_WB_WBDC_EST2_LOAD_Q_WB0_ADDR A:0x4364084
y.create.l HWIO_RXFE_WB_VSRC_CFG_WB0_ADDR A:0x4364088
y.create.l HWIO_RXFE_WB_VSRC_T2BYT1M1_WB0_ADDR A:0x436408c
y.create.l HWIO_RXFE_WB_VSRC_CMD_WB0_ADDR A:0x4364090
y.create.l HWIO_RXFE_WB_VSRC_STATUS_WB0_ADDR A:0x4364094
y.create.l HWIO_RXFE_WB_VSRC_UPDT_ACTION_SAMPLE_WB0_ADDR A:0x4364098
y.create.l HWIO_RXFE_WB_VSRC_CURR_T1BYT2_WB0_ADDR A:0x436409c
y.create.l HWIO_RXFE_WB_VSRC_CURR_T2BYT1M1_WB0_ADDR A:0x43640a0
y.create.l HWIO_RXFE_WB_VSRC_SCTR_LOAD_VALUE_WB0_ADDR A:0x43640a4
y.create.l HWIO_RXFE_WB_VSRC_SCTR_WA_WB0_ADDR A:0x43640a8
y.create.l HWIO_RXFE_WB_VSRC_SCTR_SNAPSHOT_WB0_ADDR A:0x43640ac
y.create.l HWIO_RXFE_WB_VSRC_ACC_SNAPSHOT_WB0_ADDR A:0x43640b0
y.create.l HWIO_RXFE_WB_DEC_FILT_CFG_WB0_ADDR A:0x43640b4
y.create.l HWIO_RXFE_WB_IQMC_CFG0_WB0_ADDR A:0x43640b8
y.create.l HWIO_RXFE_WB_IQMC_CFG1_WB0_ADDR A:0x43640bc
y.create.l HWIO_RXFE_WB_IQMC_CURR_VALS_WB0_ADDR A:0x43640c0
y.create.l HWIO_RXFE_WB_IQMC_UPDT_CMD_WB0_ADDR A:0x43640c4
y.create.l HWIO_RXFE_WB_IQMC_UPDT_ACTION_SAMPLE_WB0_ADDR A:0x43640c8
y.create.l HWIO_RXFE_WB_NOTCH_FILT0_CFG0_WB0_ADDR A:0x43640cc
y.create.l HWIO_RXFE_WB_NOTCH_FILT1_CFG0_WB0_ADDR A:0x43640d4
y.create.l HWIO_RXFE_WB_NOTCH_FILT2_CFG0_WB0_ADDR A:0x43640dc
y.create.l HWIO_RXFE_WB_NOTCH_FILT0_CFG1_WB0_ADDR A:0x43640d0
y.create.l HWIO_RXFE_WB_NOTCH_FILT1_CFG1_WB0_ADDR A:0x43640d8
y.create.l HWIO_RXFE_WB_NOTCH_FILT2_CFG1_WB0_ADDR A:0x43640e0
y.create.l HWIO_RXFE_WB_NOTCH_FILT012_CFG_WB0_ADDR A:0x43640e4
y.create.l HWIO_RXFE_WB_SPARE_REG_WB0_ADDR A:0x43640e8
y.create.l HWIO_RXFE_WB_TOP_CTL_WB1_ADDR A:0x4365000
y.create.l HWIO_RXFE_WB_TOP_CMD_WB1_ADDR A:0x4365004
y.create.l HWIO_RXFE_WB_TOP_STATUS_WB1_ADDR A:0x4365008
y.create.l HWIO_RXFE_WB_STOPGATE_ACTION_SAMPLE_WB1_ADDR A:0x436500c
y.create.l HWIO_RXFE_WB_TIMINGCTL_STATUS_WB1_ADDR A:0x4365010
y.create.l HWIO_RXFE_WB_MISC_CFG_WB1_ADDR A:0x4365014
y.create.l HWIO_RXFE_WB_WBPWR_CFG_WB1_ADDR A:0x4365018
y.create.l HWIO_RXFE_WB_WBPWR_CMD_WB1_ADDR A:0x436501c
y.create.l HWIO_RXFE_WB_WBPWR_START_ACTION_SAMPLE_WB1_ADDR A:0x4365020
y.create.l HWIO_RXFE_WB_WBPWR_START_MASK_WB1_ADDR A:0x4365024
y.create.l HWIO_RXFE_WB_WBPWR_STOP_ACTION_SAMPLE_WB1_ADDR A:0x4365028
y.create.l HWIO_RXFE_WB_WBPWR_FINAL_ACC_WB1_ADDR A:0x436502c
y.create.l HWIO_RXFE_WB_WBPWR_CURR_ACC_WB1_ADDR A:0x4365030
y.create.l HWIO_RXFE_WB_WBPWR_MAX_ACC_WB1_ADDR A:0x4365034
y.create.l HWIO_RXFE_WB_WBDC_CFG_WB1_ADDR A:0x4365038
y.create.l HWIO_RXFE_WB_WBDC_CMD_WB1_ADDR A:0x436503c
y.create.l HWIO_RXFE_WB_WBDC_START_ACTION_SAMPLE_WB1_ADDR A:0x4365040
y.create.l HWIO_RXFE_WB_WBDC_STOP_ACTION_SAMPLE_WB1_ADDR A:0x4365044
y.create.l HWIO_RXFE_WB_WBDC_UPDATE_ACTION_SAMPLE_WB1_ADDR A:0x4365048
y.create.l HWIO_RXFE_WB_WBDC_UPDATE_DELAY_WB1_ADDR A:0x436504c
y.create.l HWIO_RXFE_WB_WBDC_OVRD_I_WB1_ADDR A:0x4365050
y.create.l HWIO_RXFE_WB_WBDC_OVRD_Q_WB1_ADDR A:0x4365054
y.create.l HWIO_RXFE_WB_WBDC_EST1_CURR_I_WB1_ADDR A:0x4365058
y.create.l HWIO_RXFE_WB_WBDC_EST1_CURR_Q_WB1_ADDR A:0x436505c
y.create.l HWIO_RXFE_WB_WBDC_EST1_PREV_I_WB1_ADDR A:0x4365060
y.create.l HWIO_RXFE_WB_WBDC_EST1_PREV_Q_WB1_ADDR A:0x4365064
y.create.l HWIO_RXFE_WB_WBDC_EST1_LOAD_I_WB1_ADDR A:0x4365068
y.create.l HWIO_RXFE_WB_WBDC_EST1_LOAD_Q_WB1_ADDR A:0x436506c
y.create.l HWIO_RXFE_WB_WBDC_EST2_CURR_I_WB1_ADDR A:0x4365070
y.create.l HWIO_RXFE_WB_WBDC_EST2_CURR_Q_WB1_ADDR A:0x4365074
y.create.l HWIO_RXFE_WB_WBDC_EST2_PREV_I_WB1_ADDR A:0x4365078
y.create.l HWIO_RXFE_WB_WBDC_EST2_PREV_Q_WB1_ADDR A:0x436507c
y.create.l HWIO_RXFE_WB_WBDC_EST2_LOAD_I_WB1_ADDR A:0x4365080
y.create.l HWIO_RXFE_WB_WBDC_EST2_LOAD_Q_WB1_ADDR A:0x4365084
y.create.l HWIO_RXFE_WB_VSRC_CFG_WB1_ADDR A:0x4365088
y.create.l HWIO_RXFE_WB_VSRC_T2BYT1M1_WB1_ADDR A:0x436508c
y.create.l HWIO_RXFE_WB_VSRC_CMD_WB1_ADDR A:0x4365090
y.create.l HWIO_RXFE_WB_VSRC_STATUS_WB1_ADDR A:0x4365094
y.create.l HWIO_RXFE_WB_VSRC_UPDT_ACTION_SAMPLE_WB1_ADDR A:0x4365098
y.create.l HWIO_RXFE_WB_VSRC_CURR_T1BYT2_WB1_ADDR A:0x436509c
y.create.l HWIO_RXFE_WB_VSRC_CURR_T2BYT1M1_WB1_ADDR A:0x43650a0
y.create.l HWIO_RXFE_WB_VSRC_SCTR_LOAD_VALUE_WB1_ADDR A:0x43650a4
y.create.l HWIO_RXFE_WB_VSRC_SCTR_WA_WB1_ADDR A:0x43650a8
y.create.l HWIO_RXFE_WB_VSRC_SCTR_SNAPSHOT_WB1_ADDR A:0x43650ac
y.create.l HWIO_RXFE_WB_VSRC_ACC_SNAPSHOT_WB1_ADDR A:0x43650b0
y.create.l HWIO_RXFE_WB_DEC_FILT_CFG_WB1_ADDR A:0x43650b4
y.create.l HWIO_RXFE_WB_IQMC_CFG0_WB1_ADDR A:0x43650b8
y.create.l HWIO_RXFE_WB_IQMC_CFG1_WB1_ADDR A:0x43650bc
y.create.l HWIO_RXFE_WB_IQMC_CURR_VALS_WB1_ADDR A:0x43650c0
y.create.l HWIO_RXFE_WB_IQMC_UPDT_CMD_WB1_ADDR A:0x43650c4
y.create.l HWIO_RXFE_WB_IQMC_UPDT_ACTION_SAMPLE_WB1_ADDR A:0x43650c8
y.create.l HWIO_RXFE_WB_NOTCH_FILT0_CFG0_WB1_ADDR A:0x43650cc
y.create.l HWIO_RXFE_WB_NOTCH_FILT1_CFG0_WB1_ADDR A:0x43650d4
y.create.l HWIO_RXFE_WB_NOTCH_FILT2_CFG0_WB1_ADDR A:0x43650dc
y.create.l HWIO_RXFE_WB_NOTCH_FILT0_CFG1_WB1_ADDR A:0x43650d0
y.create.l HWIO_RXFE_WB_NOTCH_FILT1_CFG1_WB1_ADDR A:0x43650d8
y.create.l HWIO_RXFE_WB_NOTCH_FILT2_CFG1_WB1_ADDR A:0x43650e0
y.create.l HWIO_RXFE_WB_NOTCH_FILT012_CFG_WB1_ADDR A:0x43650e4
y.create.l HWIO_RXFE_WB_SPARE_REG_WB1_ADDR A:0x43650e8
y.create.l HWIO_RXFE_WB_TOP_CTL_WB2_ADDR A:0x4366000
y.create.l HWIO_RXFE_WB_TOP_CMD_WB2_ADDR A:0x4366004
y.create.l HWIO_RXFE_WB_TOP_STATUS_WB2_ADDR A:0x4366008
y.create.l HWIO_RXFE_WB_STOPGATE_ACTION_SAMPLE_WB2_ADDR A:0x436600c
y.create.l HWIO_RXFE_WB_TIMINGCTL_STATUS_WB2_ADDR A:0x4366010
y.create.l HWIO_RXFE_WB_MISC_CFG_WB2_ADDR A:0x4366014
y.create.l HWIO_RXFE_WB_WBPWR_CFG_WB2_ADDR A:0x4366018
y.create.l HWIO_RXFE_WB_WBPWR_CMD_WB2_ADDR A:0x436601c
y.create.l HWIO_RXFE_WB_WBPWR_START_ACTION_SAMPLE_WB2_ADDR A:0x4366020
y.create.l HWIO_RXFE_WB_WBPWR_START_MASK_WB2_ADDR A:0x4366024
y.create.l HWIO_RXFE_WB_WBPWR_STOP_ACTION_SAMPLE_WB2_ADDR A:0x4366028
y.create.l HWIO_RXFE_WB_WBPWR_FINAL_ACC_WB2_ADDR A:0x436602c
y.create.l HWIO_RXFE_WB_WBPWR_CURR_ACC_WB2_ADDR A:0x4366030
y.create.l HWIO_RXFE_WB_WBPWR_MAX_ACC_WB2_ADDR A:0x4366034
y.create.l HWIO_RXFE_WB_WBDC_CFG_WB2_ADDR A:0x4366038
y.create.l HWIO_RXFE_WB_WBDC_CMD_WB2_ADDR A:0x436603c
y.create.l HWIO_RXFE_WB_WBDC_START_ACTION_SAMPLE_WB2_ADDR A:0x4366040
y.create.l HWIO_RXFE_WB_WBDC_STOP_ACTION_SAMPLE_WB2_ADDR A:0x4366044
y.create.l HWIO_RXFE_WB_WBDC_UPDATE_ACTION_SAMPLE_WB2_ADDR A:0x4366048
y.create.l HWIO_RXFE_WB_WBDC_UPDATE_DELAY_WB2_ADDR A:0x436604c
y.create.l HWIO_RXFE_WB_WBDC_OVRD_I_WB2_ADDR A:0x4366050
y.create.l HWIO_RXFE_WB_WBDC_OVRD_Q_WB2_ADDR A:0x4366054
y.create.l HWIO_RXFE_WB_WBDC_EST1_CURR_I_WB2_ADDR A:0x4366058
y.create.l HWIO_RXFE_WB_WBDC_EST1_CURR_Q_WB2_ADDR A:0x436605c
y.create.l HWIO_RXFE_WB_WBDC_EST1_PREV_I_WB2_ADDR A:0x4366060
y.create.l HWIO_RXFE_WB_WBDC_EST1_PREV_Q_WB2_ADDR A:0x4366064
y.create.l HWIO_RXFE_WB_WBDC_EST1_LOAD_I_WB2_ADDR A:0x4366068
y.create.l HWIO_RXFE_WB_WBDC_EST1_LOAD_Q_WB2_ADDR A:0x436606c
y.create.l HWIO_RXFE_WB_WBDC_EST2_CURR_I_WB2_ADDR A:0x4366070
y.create.l HWIO_RXFE_WB_WBDC_EST2_CURR_Q_WB2_ADDR A:0x4366074
y.create.l HWIO_RXFE_WB_WBDC_EST2_PREV_I_WB2_ADDR A:0x4366078
y.create.l HWIO_RXFE_WB_WBDC_EST2_PREV_Q_WB2_ADDR A:0x436607c
y.create.l HWIO_RXFE_WB_WBDC_EST2_LOAD_I_WB2_ADDR A:0x4366080
y.create.l HWIO_RXFE_WB_WBDC_EST2_LOAD_Q_WB2_ADDR A:0x4366084
y.create.l HWIO_RXFE_WB_VSRC_CFG_WB2_ADDR A:0x4366088
y.create.l HWIO_RXFE_WB_VSRC_T2BYT1M1_WB2_ADDR A:0x436608c
y.create.l HWIO_RXFE_WB_VSRC_CMD_WB2_ADDR A:0x4366090
y.create.l HWIO_RXFE_WB_VSRC_STATUS_WB2_ADDR A:0x4366094
y.create.l HWIO_RXFE_WB_VSRC_UPDT_ACTION_SAMPLE_WB2_ADDR A:0x4366098
y.create.l HWIO_RXFE_WB_VSRC_CURR_T1BYT2_WB2_ADDR A:0x436609c
y.create.l HWIO_RXFE_WB_VSRC_CURR_T2BYT1M1_WB2_ADDR A:0x43660a0
y.create.l HWIO_RXFE_WB_VSRC_SCTR_LOAD_VALUE_WB2_ADDR A:0x43660a4
y.create.l HWIO_RXFE_WB_VSRC_SCTR_WA_WB2_ADDR A:0x43660a8
y.create.l HWIO_RXFE_WB_VSRC_SCTR_SNAPSHOT_WB2_ADDR A:0x43660ac
y.create.l HWIO_RXFE_WB_VSRC_ACC_SNAPSHOT_WB2_ADDR A:0x43660b0
y.create.l HWIO_RXFE_WB_DEC_FILT_CFG_WB2_ADDR A:0x43660b4
y.create.l HWIO_RXFE_WB_IQMC_CFG0_WB2_ADDR A:0x43660b8
y.create.l HWIO_RXFE_WB_IQMC_CFG1_WB2_ADDR A:0x43660bc
y.create.l HWIO_RXFE_WB_IQMC_CURR_VALS_WB2_ADDR A:0x43660c0
y.create.l HWIO_RXFE_WB_IQMC_UPDT_CMD_WB2_ADDR A:0x43660c4
y.create.l HWIO_RXFE_WB_IQMC_UPDT_ACTION_SAMPLE_WB2_ADDR A:0x43660c8
y.create.l HWIO_RXFE_WB_NOTCH_FILT0_CFG0_WB2_ADDR A:0x43660cc
y.create.l HWIO_RXFE_WB_NOTCH_FILT1_CFG0_WB2_ADDR A:0x43660d4
y.create.l HWIO_RXFE_WB_NOTCH_FILT2_CFG0_WB2_ADDR A:0x43660dc
y.create.l HWIO_RXFE_WB_NOTCH_FILT0_CFG1_WB2_ADDR A:0x43660d0
y.create.l HWIO_RXFE_WB_NOTCH_FILT1_CFG1_WB2_ADDR A:0x43660d8
y.create.l HWIO_RXFE_WB_NOTCH_FILT2_CFG1_WB2_ADDR A:0x43660e0
y.create.l HWIO_RXFE_WB_NOTCH_FILT012_CFG_WB2_ADDR A:0x43660e4
y.create.l HWIO_RXFE_WB_SPARE_REG_WB2_ADDR A:0x43660e8
y.create.l HWIO_RXFE_WB_TOP_CTL_WB3_ADDR A:0x4367000
y.create.l HWIO_RXFE_WB_TOP_CMD_WB3_ADDR A:0x4367004
y.create.l HWIO_RXFE_WB_TOP_STATUS_WB3_ADDR A:0x4367008
y.create.l HWIO_RXFE_WB_STOPGATE_ACTION_SAMPLE_WB3_ADDR A:0x436700c
y.create.l HWIO_RXFE_WB_TIMINGCTL_STATUS_WB3_ADDR A:0x4367010
y.create.l HWIO_RXFE_WB_MISC_CFG_WB3_ADDR A:0x4367014
y.create.l HWIO_RXFE_WB_WBPWR_CFG_WB3_ADDR A:0x4367018
y.create.l HWIO_RXFE_WB_WBPWR_CMD_WB3_ADDR A:0x436701c
y.create.l HWIO_RXFE_WB_WBPWR_START_ACTION_SAMPLE_WB3_ADDR A:0x4367020
y.create.l HWIO_RXFE_WB_WBPWR_START_MASK_WB3_ADDR A:0x4367024
y.create.l HWIO_RXFE_WB_WBPWR_STOP_ACTION_SAMPLE_WB3_ADDR A:0x4367028
y.create.l HWIO_RXFE_WB_WBPWR_FINAL_ACC_WB3_ADDR A:0x436702c
y.create.l HWIO_RXFE_WB_WBPWR_CURR_ACC_WB3_ADDR A:0x4367030
y.create.l HWIO_RXFE_WB_WBPWR_MAX_ACC_WB3_ADDR A:0x4367034
y.create.l HWIO_RXFE_WB_WBDC_CFG_WB3_ADDR A:0x4367038
y.create.l HWIO_RXFE_WB_WBDC_CMD_WB3_ADDR A:0x436703c
y.create.l HWIO_RXFE_WB_WBDC_START_ACTION_SAMPLE_WB3_ADDR A:0x4367040
y.create.l HWIO_RXFE_WB_WBDC_STOP_ACTION_SAMPLE_WB3_ADDR A:0x4367044
y.create.l HWIO_RXFE_WB_WBDC_UPDATE_ACTION_SAMPLE_WB3_ADDR A:0x4367048
y.create.l HWIO_RXFE_WB_WBDC_UPDATE_DELAY_WB3_ADDR A:0x436704c
y.create.l HWIO_RXFE_WB_WBDC_OVRD_I_WB3_ADDR A:0x4367050
y.create.l HWIO_RXFE_WB_WBDC_OVRD_Q_WB3_ADDR A:0x4367054
y.create.l HWIO_RXFE_WB_WBDC_EST1_CURR_I_WB3_ADDR A:0x4367058
y.create.l HWIO_RXFE_WB_WBDC_EST1_CURR_Q_WB3_ADDR A:0x436705c
y.create.l HWIO_RXFE_WB_WBDC_EST1_PREV_I_WB3_ADDR A:0x4367060
y.create.l HWIO_RXFE_WB_WBDC_EST1_PREV_Q_WB3_ADDR A:0x4367064
y.create.l HWIO_RXFE_WB_WBDC_EST1_LOAD_I_WB3_ADDR A:0x4367068
y.create.l HWIO_RXFE_WB_WBDC_EST1_LOAD_Q_WB3_ADDR A:0x436706c
y.create.l HWIO_RXFE_WB_WBDC_EST2_CURR_I_WB3_ADDR A:0x4367070
y.create.l HWIO_RXFE_WB_WBDC_EST2_CURR_Q_WB3_ADDR A:0x4367074
y.create.l HWIO_RXFE_WB_WBDC_EST2_PREV_I_WB3_ADDR A:0x4367078
y.create.l HWIO_RXFE_WB_WBDC_EST2_PREV_Q_WB3_ADDR A:0x436707c
y.create.l HWIO_RXFE_WB_WBDC_EST2_LOAD_I_WB3_ADDR A:0x4367080
y.create.l HWIO_RXFE_WB_WBDC_EST2_LOAD_Q_WB3_ADDR A:0x4367084
y.create.l HWIO_RXFE_WB_VSRC_CFG_WB3_ADDR A:0x4367088
y.create.l HWIO_RXFE_WB_VSRC_T2BYT1M1_WB3_ADDR A:0x436708c
y.create.l HWIO_RXFE_WB_VSRC_CMD_WB3_ADDR A:0x4367090
y.create.l HWIO_RXFE_WB_VSRC_STATUS_WB3_ADDR A:0x4367094
y.create.l HWIO_RXFE_WB_VSRC_UPDT_ACTION_SAMPLE_WB3_ADDR A:0x4367098
y.create.l HWIO_RXFE_WB_VSRC_CURR_T1BYT2_WB3_ADDR A:0x436709c
y.create.l HWIO_RXFE_WB_VSRC_CURR_T2BYT1M1_WB3_ADDR A:0x43670a0
y.create.l HWIO_RXFE_WB_VSRC_SCTR_LOAD_VALUE_WB3_ADDR A:0x43670a4
y.create.l HWIO_RXFE_WB_VSRC_SCTR_WA_WB3_ADDR A:0x43670a8
y.create.l HWIO_RXFE_WB_VSRC_SCTR_SNAPSHOT_WB3_ADDR A:0x43670ac
y.create.l HWIO_RXFE_WB_VSRC_ACC_SNAPSHOT_WB3_ADDR A:0x43670b0
y.create.l HWIO_RXFE_WB_DEC_FILT_CFG_WB3_ADDR A:0x43670b4
y.create.l HWIO_RXFE_WB_IQMC_CFG0_WB3_ADDR A:0x43670b8
y.create.l HWIO_RXFE_WB_IQMC_CFG1_WB3_ADDR A:0x43670bc
y.create.l HWIO_RXFE_WB_IQMC_CURR_VALS_WB3_ADDR A:0x43670c0
y.create.l HWIO_RXFE_WB_IQMC_UPDT_CMD_WB3_ADDR A:0x43670c4
y.create.l HWIO_RXFE_WB_IQMC_UPDT_ACTION_SAMPLE_WB3_ADDR A:0x43670c8
y.create.l HWIO_RXFE_WB_NOTCH_FILT0_CFG0_WB3_ADDR A:0x43670cc
y.create.l HWIO_RXFE_WB_NOTCH_FILT1_CFG0_WB3_ADDR A:0x43670d4
y.create.l HWIO_RXFE_WB_NOTCH_FILT2_CFG0_WB3_ADDR A:0x43670dc
y.create.l HWIO_RXFE_WB_NOTCH_FILT0_CFG1_WB3_ADDR A:0x43670d0
y.create.l HWIO_RXFE_WB_NOTCH_FILT1_CFG1_WB3_ADDR A:0x43670d8
y.create.l HWIO_RXFE_WB_NOTCH_FILT2_CFG1_WB3_ADDR A:0x43670e0
y.create.l HWIO_RXFE_WB_NOTCH_FILT012_CFG_WB3_ADDR A:0x43670e4
y.create.l HWIO_RXFE_WB_SPARE_REG_WB3_ADDR A:0x43670e8
y.create.l HWIO_RXFE_NB_TOP_CTL_NB0_ADDR A:0x4370000
y.create.l HWIO_RXFE_NB_GATE_CMD_NB0_ADDR A:0x4370004
y.create.l HWIO_RXFE_NB_GATE_STATUS_NB0_ADDR A:0x4370008
y.create.l HWIO_RXFE_NB_GATE_ACTION_SAMPLE_NB0_ADDR A:0x437000c
y.create.l HWIO_RXFE_NB_TIMINGCTL_STATUS_NB0_ADDR A:0x4370010
y.create.l HWIO_RXFE_NB_CSR_CFG_NB0_ADDR A:0x4370014
y.create.l HWIO_RXFE_NB_CSR_CMD_NB0_ADDR A:0x4370018
y.create.l HWIO_RXFE_NB_CSR_PHASEUPDT_ACTION_SAMPLE_NB0_ADDR A:0x437001c
y.create.l HWIO_RXFE_NB_CSR_FREQUPDT_ACTION_SAMPLE_NB0_ADDR A:0x4370020
y.create.l HWIO_RXFE_NB_CSR_PHASE_OFFSET_NB0_ADDR A:0x4370024
y.create.l HWIO_RXFE_NB_CSR_FREQ_OFFSET_NB0_ADDR A:0x4370028
y.create.l HWIO_RXFE_NB_CSR_CURR_PHASE_OFFSET_NB0_ADDR A:0x437002c
y.create.l HWIO_RXFE_NB_CSR_CURR_FREQ_OFFSET_NB0_ADDR A:0x4370030
y.create.l HWIO_RXFE_NB_FILTERS_CFG_NB0_ADDR A:0x4370034
y.create.l HWIO_RXFE_NB_ICI_COEF0_NB0_ADDR A:0x437003c
y.create.l HWIO_RXFE_NB_ICI_COEF1_NB0_ADDR A:0x4370040
y.create.l HWIO_RXFE_NB_ICI_COEF2_NB0_ADDR A:0x4370044
y.create.l HWIO_RXFE_NB_ICI_COEF3_NB0_ADDR A:0x4370048
y.create.l HWIO_RXFE_NB_ICI_COEF4_NB0_ADDR A:0x437004c
y.create.l HWIO_RXFE_NB_ICI_COEF5_NB0_ADDR A:0x4370050
y.create.l HWIO_RXFE_NB_ICI_COEF6_NB0_ADDR A:0x4370054
y.create.l HWIO_RXFE_NB_ICI_COEF7_NB0_ADDR A:0x4370058
y.create.l HWIO_RXFE_NB_ICI_COEF8_NB0_ADDR A:0x437005c
y.create.l HWIO_RXFE_NB_ICI_COEF9_NB0_ADDR A:0x4370060
y.create.l HWIO_RXFE_NB_GDA_NB0_ADDR A:0x4370068
y.create.l HWIO_RXFE_NB_NBDC_COMPVAL_I_NB0_ADDR A:0x437006c
y.create.l HWIO_RXFE_NB_NBDC_COMPVAL_Q_NB0_ADDR A:0x4370070
y.create.l HWIO_RXFE_NB_NBPWR_CFG_NB0_ADDR A:0x4370074
y.create.l HWIO_RXFE_NB_NBPWR_CMD_NB0_ADDR A:0x4370078
y.create.l HWIO_RXFE_NB_NBPWR_START_ACTION_SAMPLE_NB0_ADDR A:0x437007c
y.create.l HWIO_RXFE_NB_NBPWR_START_MASK_NB0_ADDR A:0x4370080
y.create.l HWIO_RXFE_NB_NBPWR_STOP_ACTION_SAMPLE_NB0_ADDR A:0x4370084
y.create.l HWIO_RXFE_NB_NBPWR_FINAL_ACC_NB0_ADDR A:0x4370088
y.create.l HWIO_RXFE_NB_NBPWR_CURR_ACC_NB0_ADDR A:0x437008c
y.create.l HWIO_RXFE_NB_NBPWR_MAX_ACC_NB0_ADDR A:0x4370090
y.create.l HWIO_RXFE_NB_DVGA_CFG_NB0_ADDR A:0x4370094
y.create.l HWIO_RXFE_NB_DVGA_RXFE_GAIN_NB0_ADDR A:0x4370098
y.create.l HWIO_RXFE_NB_DVGA_OVERRIDE_DVGA_GAIN_NB0_ADDR A:0x437009c
y.create.l HWIO_RXFE_NB_DVGA_CMD_NB0_ADDR A:0x43700a0
y.create.l HWIO_RXFE_NB_DVGA_UPDT_ACTION_SAMPLE_NB0_ADDR A:0x43700a4
y.create.l HWIO_RXFE_NB_DVGA_UPDT_MASK_NB0_ADDR A:0x43700a8
y.create.l HWIO_RXFE_NB_FINAL_BITWIDTHS_CFG_NB0_ADDR A:0x43700ac
y.create.l HWIO_RXFE_NB_FINAL_SWAP_NB0_ADDR A:0x43700dc
y.create.l HWIO_RXFE_NB_WTR_CFG_NB0_ADDR A:0x43700b0
y.create.l HWIO_RXFE_NB_WTR_FUNC_CFG_NB0_ADDR A:0x43700b4
y.create.l HWIO_RXFE_NB_WTR_DBG_CFG0_NB0_ADDR A:0x43700b8
y.create.l HWIO_RXFE_NB_WTR_DBG_CFG1_NB0_ADDR A:0x43700bc
y.create.l HWIO_RXFE_NB_WTR_CMD_NB0_ADDR A:0x43700c0
y.create.l HWIO_RXFE_NB_WTR_START_ACTION_SAMPLE_NB0_ADDR A:0x43700c4
y.create.l HWIO_RXFE_NB_WTR_STOP_ACTION_SAMPLE_NB0_ADDR A:0x43700c8
y.create.l HWIO_RXFE_NB_WTR_STATUS_NB0_ADDR A:0x43700d0
y.create.l HWIO_RXFE_NB_WTR_ADDR_SNAPSHOT_NB0_ADDR A:0x43700d4
y.create.l HWIO_RXFE_NB_SPARE_REG_NB0_ADDR A:0x43700d8
y.create.l HWIO_RXFE_NB_TOP_CTL_NB1_ADDR A:0x4371000
y.create.l HWIO_RXFE_NB_GATE_CMD_NB1_ADDR A:0x4371004
y.create.l HWIO_RXFE_NB_GATE_STATUS_NB1_ADDR A:0x4371008
y.create.l HWIO_RXFE_NB_GATE_ACTION_SAMPLE_NB1_ADDR A:0x437100c
y.create.l HWIO_RXFE_NB_TIMINGCTL_STATUS_NB1_ADDR A:0x4371010
y.create.l HWIO_RXFE_NB_CSR_CFG_NB1_ADDR A:0x4371014
y.create.l HWIO_RXFE_NB_CSR_CMD_NB1_ADDR A:0x4371018
y.create.l HWIO_RXFE_NB_CSR_PHASEUPDT_ACTION_SAMPLE_NB1_ADDR A:0x437101c
y.create.l HWIO_RXFE_NB_CSR_FREQUPDT_ACTION_SAMPLE_NB1_ADDR A:0x4371020
y.create.l HWIO_RXFE_NB_CSR_PHASE_OFFSET_NB1_ADDR A:0x4371024
y.create.l HWIO_RXFE_NB_CSR_FREQ_OFFSET_NB1_ADDR A:0x4371028
y.create.l HWIO_RXFE_NB_CSR_CURR_PHASE_OFFSET_NB1_ADDR A:0x437102c
y.create.l HWIO_RXFE_NB_CSR_CURR_FREQ_OFFSET_NB1_ADDR A:0x4371030
y.create.l HWIO_RXFE_NB_FILTERS_CFG_NB1_ADDR A:0x4371034
y.create.l HWIO_RXFE_NB_ICI_COEF0_NB1_ADDR A:0x437103c
y.create.l HWIO_RXFE_NB_ICI_COEF1_NB1_ADDR A:0x4371040
y.create.l HWIO_RXFE_NB_ICI_COEF2_NB1_ADDR A:0x4371044
y.create.l HWIO_RXFE_NB_ICI_COEF3_NB1_ADDR A:0x4371048
y.create.l HWIO_RXFE_NB_ICI_COEF4_NB1_ADDR A:0x437104c
y.create.l HWIO_RXFE_NB_ICI_COEF5_NB1_ADDR A:0x4371050
y.create.l HWIO_RXFE_NB_ICI_COEF6_NB1_ADDR A:0x4371054
y.create.l HWIO_RXFE_NB_ICI_COEF7_NB1_ADDR A:0x4371058
y.create.l HWIO_RXFE_NB_ICI_COEF8_NB1_ADDR A:0x437105c
y.create.l HWIO_RXFE_NB_ICI_COEF9_NB1_ADDR A:0x4371060
y.create.l HWIO_RXFE_NB_GDA_NB1_ADDR A:0x4371068
y.create.l HWIO_RXFE_NB_NBDC_COMPVAL_I_NB1_ADDR A:0x437106c
y.create.l HWIO_RXFE_NB_NBDC_COMPVAL_Q_NB1_ADDR A:0x4371070
y.create.l HWIO_RXFE_NB_NBPWR_CFG_NB1_ADDR A:0x4371074
y.create.l HWIO_RXFE_NB_NBPWR_CMD_NB1_ADDR A:0x4371078
y.create.l HWIO_RXFE_NB_NBPWR_START_ACTION_SAMPLE_NB1_ADDR A:0x437107c
y.create.l HWIO_RXFE_NB_NBPWR_START_MASK_NB1_ADDR A:0x4371080
y.create.l HWIO_RXFE_NB_NBPWR_STOP_ACTION_SAMPLE_NB1_ADDR A:0x4371084
y.create.l HWIO_RXFE_NB_NBPWR_FINAL_ACC_NB1_ADDR A:0x4371088
y.create.l HWIO_RXFE_NB_NBPWR_CURR_ACC_NB1_ADDR A:0x437108c
y.create.l HWIO_RXFE_NB_NBPWR_MAX_ACC_NB1_ADDR A:0x4371090
y.create.l HWIO_RXFE_NB_DVGA_CFG_NB1_ADDR A:0x4371094
y.create.l HWIO_RXFE_NB_DVGA_RXFE_GAIN_NB1_ADDR A:0x4371098
y.create.l HWIO_RXFE_NB_DVGA_OVERRIDE_DVGA_GAIN_NB1_ADDR A:0x437109c
y.create.l HWIO_RXFE_NB_DVGA_CMD_NB1_ADDR A:0x43710a0
y.create.l HWIO_RXFE_NB_DVGA_UPDT_ACTION_SAMPLE_NB1_ADDR A:0x43710a4
y.create.l HWIO_RXFE_NB_DVGA_UPDT_MASK_NB1_ADDR A:0x43710a8
y.create.l HWIO_RXFE_NB_FINAL_BITWIDTHS_CFG_NB1_ADDR A:0x43710ac
y.create.l HWIO_RXFE_NB_FINAL_SWAP_NB1_ADDR A:0x43710dc
y.create.l HWIO_RXFE_NB_WTR_CFG_NB1_ADDR A:0x43710b0
y.create.l HWIO_RXFE_NB_WTR_FUNC_CFG_NB1_ADDR A:0x43710b4
y.create.l HWIO_RXFE_NB_WTR_DBG_CFG0_NB1_ADDR A:0x43710b8
y.create.l HWIO_RXFE_NB_WTR_DBG_CFG1_NB1_ADDR A:0x43710bc
y.create.l HWIO_RXFE_NB_WTR_CMD_NB1_ADDR A:0x43710c0
y.create.l HWIO_RXFE_NB_WTR_START_ACTION_SAMPLE_NB1_ADDR A:0x43710c4
y.create.l HWIO_RXFE_NB_WTR_STOP_ACTION_SAMPLE_NB1_ADDR A:0x43710c8
y.create.l HWIO_RXFE_NB_WTR_STATUS_NB1_ADDR A:0x43710d0
y.create.l HWIO_RXFE_NB_WTR_ADDR_SNAPSHOT_NB1_ADDR A:0x43710d4
y.create.l HWIO_RXFE_NB_SPARE_REG_NB1_ADDR A:0x43710d8
y.create.l HWIO_RXFE_NB_TOP_CTL_NB2_ADDR A:0x4372000
y.create.l HWIO_RXFE_NB_GATE_CMD_NB2_ADDR A:0x4372004
y.create.l HWIO_RXFE_NB_GATE_STATUS_NB2_ADDR A:0x4372008
y.create.l HWIO_RXFE_NB_GATE_ACTION_SAMPLE_NB2_ADDR A:0x437200c
y.create.l HWIO_RXFE_NB_TIMINGCTL_STATUS_NB2_ADDR A:0x4372010
y.create.l HWIO_RXFE_NB_CSR_CFG_NB2_ADDR A:0x4372014
y.create.l HWIO_RXFE_NB_CSR_CMD_NB2_ADDR A:0x4372018
y.create.l HWIO_RXFE_NB_CSR_PHASEUPDT_ACTION_SAMPLE_NB2_ADDR A:0x437201c
y.create.l HWIO_RXFE_NB_CSR_FREQUPDT_ACTION_SAMPLE_NB2_ADDR A:0x4372020
y.create.l HWIO_RXFE_NB_CSR_PHASE_OFFSET_NB2_ADDR A:0x4372024
y.create.l HWIO_RXFE_NB_CSR_FREQ_OFFSET_NB2_ADDR A:0x4372028
y.create.l HWIO_RXFE_NB_CSR_CURR_PHASE_OFFSET_NB2_ADDR A:0x437202c
y.create.l HWIO_RXFE_NB_CSR_CURR_FREQ_OFFSET_NB2_ADDR A:0x4372030
y.create.l HWIO_RXFE_NB_FILTERS_CFG_NB2_ADDR A:0x4372034
y.create.l HWIO_RXFE_NB_ICI_COEF0_NB2_ADDR A:0x437203c
y.create.l HWIO_RXFE_NB_ICI_COEF1_NB2_ADDR A:0x4372040
y.create.l HWIO_RXFE_NB_ICI_COEF2_NB2_ADDR A:0x4372044
y.create.l HWIO_RXFE_NB_ICI_COEF3_NB2_ADDR A:0x4372048
y.create.l HWIO_RXFE_NB_ICI_COEF4_NB2_ADDR A:0x437204c
y.create.l HWIO_RXFE_NB_ICI_COEF5_NB2_ADDR A:0x4372050
y.create.l HWIO_RXFE_NB_ICI_COEF6_NB2_ADDR A:0x4372054
y.create.l HWIO_RXFE_NB_ICI_COEF7_NB2_ADDR A:0x4372058
y.create.l HWIO_RXFE_NB_ICI_COEF8_NB2_ADDR A:0x437205c
y.create.l HWIO_RXFE_NB_ICI_COEF9_NB2_ADDR A:0x4372060
y.create.l HWIO_RXFE_NB_GDA_NB2_ADDR A:0x4372068
y.create.l HWIO_RXFE_NB_NBDC_COMPVAL_I_NB2_ADDR A:0x437206c
y.create.l HWIO_RXFE_NB_NBDC_COMPVAL_Q_NB2_ADDR A:0x4372070
y.create.l HWIO_RXFE_NB_NBPWR_CFG_NB2_ADDR A:0x4372074
y.create.l HWIO_RXFE_NB_NBPWR_CMD_NB2_ADDR A:0x4372078
y.create.l HWIO_RXFE_NB_NBPWR_START_ACTION_SAMPLE_NB2_ADDR A:0x437207c
y.create.l HWIO_RXFE_NB_NBPWR_START_MASK_NB2_ADDR A:0x4372080
y.create.l HWIO_RXFE_NB_NBPWR_STOP_ACTION_SAMPLE_NB2_ADDR A:0x4372084
y.create.l HWIO_RXFE_NB_NBPWR_FINAL_ACC_NB2_ADDR A:0x4372088
y.create.l HWIO_RXFE_NB_NBPWR_CURR_ACC_NB2_ADDR A:0x437208c
y.create.l HWIO_RXFE_NB_NBPWR_MAX_ACC_NB2_ADDR A:0x4372090
y.create.l HWIO_RXFE_NB_DVGA_CFG_NB2_ADDR A:0x4372094
y.create.l HWIO_RXFE_NB_DVGA_RXFE_GAIN_NB2_ADDR A:0x4372098
y.create.l HWIO_RXFE_NB_DVGA_OVERRIDE_DVGA_GAIN_NB2_ADDR A:0x437209c
y.create.l HWIO_RXFE_NB_DVGA_CMD_NB2_ADDR A:0x43720a0
y.create.l HWIO_RXFE_NB_DVGA_UPDT_ACTION_SAMPLE_NB2_ADDR A:0x43720a4
y.create.l HWIO_RXFE_NB_DVGA_UPDT_MASK_NB2_ADDR A:0x43720a8
y.create.l HWIO_RXFE_NB_FINAL_BITWIDTHS_CFG_NB2_ADDR A:0x43720ac
y.create.l HWIO_RXFE_NB_FINAL_SWAP_NB2_ADDR A:0x43720dc
y.create.l HWIO_RXFE_NB_WTR_CFG_NB2_ADDR A:0x43720b0
y.create.l HWIO_RXFE_NB_WTR_FUNC_CFG_NB2_ADDR A:0x43720b4
y.create.l HWIO_RXFE_NB_WTR_DBG_CFG0_NB2_ADDR A:0x43720b8
y.create.l HWIO_RXFE_NB_WTR_DBG_CFG1_NB2_ADDR A:0x43720bc
y.create.l HWIO_RXFE_NB_WTR_CMD_NB2_ADDR A:0x43720c0
y.create.l HWIO_RXFE_NB_WTR_START_ACTION_SAMPLE_NB2_ADDR A:0x43720c4
y.create.l HWIO_RXFE_NB_WTR_STOP_ACTION_SAMPLE_NB2_ADDR A:0x43720c8
y.create.l HWIO_RXFE_NB_WTR_STATUS_NB2_ADDR A:0x43720d0
y.create.l HWIO_RXFE_NB_WTR_ADDR_SNAPSHOT_NB2_ADDR A:0x43720d4
y.create.l HWIO_RXFE_NB_SPARE_REG_NB2_ADDR A:0x43720d8
y.create.l HWIO_RXFE_NB_TOP_CTL_NB3_ADDR A:0x4373000
y.create.l HWIO_RXFE_NB_GATE_CMD_NB3_ADDR A:0x4373004
y.create.l HWIO_RXFE_NB_GATE_STATUS_NB3_ADDR A:0x4373008
y.create.l HWIO_RXFE_NB_GATE_ACTION_SAMPLE_NB3_ADDR A:0x437300c
y.create.l HWIO_RXFE_NB_TIMINGCTL_STATUS_NB3_ADDR A:0x4373010
y.create.l HWIO_RXFE_NB_CSR_CFG_NB3_ADDR A:0x4373014
y.create.l HWIO_RXFE_NB_CSR_CMD_NB3_ADDR A:0x4373018
y.create.l HWIO_RXFE_NB_CSR_PHASEUPDT_ACTION_SAMPLE_NB3_ADDR A:0x437301c
y.create.l HWIO_RXFE_NB_CSR_FREQUPDT_ACTION_SAMPLE_NB3_ADDR A:0x4373020
y.create.l HWIO_RXFE_NB_CSR_PHASE_OFFSET_NB3_ADDR A:0x4373024
y.create.l HWIO_RXFE_NB_CSR_FREQ_OFFSET_NB3_ADDR A:0x4373028
y.create.l HWIO_RXFE_NB_CSR_CURR_PHASE_OFFSET_NB3_ADDR A:0x437302c
y.create.l HWIO_RXFE_NB_CSR_CURR_FREQ_OFFSET_NB3_ADDR A:0x4373030
y.create.l HWIO_RXFE_NB_FILTERS_CFG_NB3_ADDR A:0x4373034
y.create.l HWIO_RXFE_NB_ICI_COEF0_NB3_ADDR A:0x437303c
y.create.l HWIO_RXFE_NB_ICI_COEF1_NB3_ADDR A:0x4373040
y.create.l HWIO_RXFE_NB_ICI_COEF2_NB3_ADDR A:0x4373044
y.create.l HWIO_RXFE_NB_ICI_COEF3_NB3_ADDR A:0x4373048
y.create.l HWIO_RXFE_NB_ICI_COEF4_NB3_ADDR A:0x437304c
y.create.l HWIO_RXFE_NB_ICI_COEF5_NB3_ADDR A:0x4373050
y.create.l HWIO_RXFE_NB_ICI_COEF6_NB3_ADDR A:0x4373054
y.create.l HWIO_RXFE_NB_ICI_COEF7_NB3_ADDR A:0x4373058
y.create.l HWIO_RXFE_NB_ICI_COEF8_NB3_ADDR A:0x437305c
y.create.l HWIO_RXFE_NB_ICI_COEF9_NB3_ADDR A:0x4373060
y.create.l HWIO_RXFE_NB_GDA_NB3_ADDR A:0x4373068
y.create.l HWIO_RXFE_NB_NBDC_COMPVAL_I_NB3_ADDR A:0x437306c
y.create.l HWIO_RXFE_NB_NBDC_COMPVAL_Q_NB3_ADDR A:0x4373070
y.create.l HWIO_RXFE_NB_NBPWR_CFG_NB3_ADDR A:0x4373074
y.create.l HWIO_RXFE_NB_NBPWR_CMD_NB3_ADDR A:0x4373078
y.create.l HWIO_RXFE_NB_NBPWR_START_ACTION_SAMPLE_NB3_ADDR A:0x437307c
y.create.l HWIO_RXFE_NB_NBPWR_START_MASK_NB3_ADDR A:0x4373080
y.create.l HWIO_RXFE_NB_NBPWR_STOP_ACTION_SAMPLE_NB3_ADDR A:0x4373084
y.create.l HWIO_RXFE_NB_NBPWR_FINAL_ACC_NB3_ADDR A:0x4373088
y.create.l HWIO_RXFE_NB_NBPWR_CURR_ACC_NB3_ADDR A:0x437308c
y.create.l HWIO_RXFE_NB_NBPWR_MAX_ACC_NB3_ADDR A:0x4373090
y.create.l HWIO_RXFE_NB_DVGA_CFG_NB3_ADDR A:0x4373094
y.create.l HWIO_RXFE_NB_DVGA_RXFE_GAIN_NB3_ADDR A:0x4373098
y.create.l HWIO_RXFE_NB_DVGA_OVERRIDE_DVGA_GAIN_NB3_ADDR A:0x437309c
y.create.l HWIO_RXFE_NB_DVGA_CMD_NB3_ADDR A:0x43730a0
y.create.l HWIO_RXFE_NB_DVGA_UPDT_ACTION_SAMPLE_NB3_ADDR A:0x43730a4
y.create.l HWIO_RXFE_NB_DVGA_UPDT_MASK_NB3_ADDR A:0x43730a8
y.create.l HWIO_RXFE_NB_FINAL_BITWIDTHS_CFG_NB3_ADDR A:0x43730ac
y.create.l HWIO_RXFE_NB_FINAL_SWAP_NB3_ADDR A:0x43730dc
y.create.l HWIO_RXFE_NB_WTR_CFG_NB3_ADDR A:0x43730b0
y.create.l HWIO_RXFE_NB_WTR_FUNC_CFG_NB3_ADDR A:0x43730b4
y.create.l HWIO_RXFE_NB_WTR_DBG_CFG0_NB3_ADDR A:0x43730b8
y.create.l HWIO_RXFE_NB_WTR_DBG_CFG1_NB3_ADDR A:0x43730bc
y.create.l HWIO_RXFE_NB_WTR_CMD_NB3_ADDR A:0x43730c0
y.create.l HWIO_RXFE_NB_WTR_START_ACTION_SAMPLE_NB3_ADDR A:0x43730c4
y.create.l HWIO_RXFE_NB_WTR_STOP_ACTION_SAMPLE_NB3_ADDR A:0x43730c8
y.create.l HWIO_RXFE_NB_WTR_STATUS_NB3_ADDR A:0x43730d0
y.create.l HWIO_RXFE_NB_WTR_ADDR_SNAPSHOT_NB3_ADDR A:0x43730d4
y.create.l HWIO_RXFE_NB_SPARE_REG_NB3_ADDR A:0x43730d8
y.create.l HWIO_RXFE_NB_TOP_CTL_NB4_ADDR A:0x4374000
y.create.l HWIO_RXFE_NB_GATE_CMD_NB4_ADDR A:0x4374004
y.create.l HWIO_RXFE_NB_GATE_STATUS_NB4_ADDR A:0x4374008
y.create.l HWIO_RXFE_NB_GATE_ACTION_SAMPLE_NB4_ADDR A:0x437400c
y.create.l HWIO_RXFE_NB_TIMINGCTL_STATUS_NB4_ADDR A:0x4374010
y.create.l HWIO_RXFE_NB_CSR_CFG_NB4_ADDR A:0x4374014
y.create.l HWIO_RXFE_NB_CSR_CMD_NB4_ADDR A:0x4374018
y.create.l HWIO_RXFE_NB_CSR_PHASEUPDT_ACTION_SAMPLE_NB4_ADDR A:0x437401c
y.create.l HWIO_RXFE_NB_CSR_FREQUPDT_ACTION_SAMPLE_NB4_ADDR A:0x4374020
y.create.l HWIO_RXFE_NB_CSR_PHASE_OFFSET_NB4_ADDR A:0x4374024
y.create.l HWIO_RXFE_NB_CSR_FREQ_OFFSET_NB4_ADDR A:0x4374028
y.create.l HWIO_RXFE_NB_CSR_CURR_PHASE_OFFSET_NB4_ADDR A:0x437402c
y.create.l HWIO_RXFE_NB_CSR_CURR_FREQ_OFFSET_NB4_ADDR A:0x4374030
y.create.l HWIO_RXFE_NB_FILTERS_CFG_NB4_ADDR A:0x4374034
y.create.l HWIO_RXFE_NB_ICI_COEF0_NB4_ADDR A:0x437403c
y.create.l HWIO_RXFE_NB_ICI_COEF1_NB4_ADDR A:0x4374040
y.create.l HWIO_RXFE_NB_ICI_COEF2_NB4_ADDR A:0x4374044
y.create.l HWIO_RXFE_NB_ICI_COEF3_NB4_ADDR A:0x4374048
y.create.l HWIO_RXFE_NB_ICI_COEF4_NB4_ADDR A:0x437404c
y.create.l HWIO_RXFE_NB_ICI_COEF5_NB4_ADDR A:0x4374050
y.create.l HWIO_RXFE_NB_ICI_COEF6_NB4_ADDR A:0x4374054
y.create.l HWIO_RXFE_NB_ICI_COEF7_NB4_ADDR A:0x4374058
y.create.l HWIO_RXFE_NB_ICI_COEF8_NB4_ADDR A:0x437405c
y.create.l HWIO_RXFE_NB_ICI_COEF9_NB4_ADDR A:0x4374060
y.create.l HWIO_RXFE_NB_GDA_NB4_ADDR A:0x4374068
y.create.l HWIO_RXFE_NB_NBDC_COMPVAL_I_NB4_ADDR A:0x437406c
y.create.l HWIO_RXFE_NB_NBDC_COMPVAL_Q_NB4_ADDR A:0x4374070
y.create.l HWIO_RXFE_NB_NBPWR_CFG_NB4_ADDR A:0x4374074
y.create.l HWIO_RXFE_NB_NBPWR_CMD_NB4_ADDR A:0x4374078
y.create.l HWIO_RXFE_NB_NBPWR_START_ACTION_SAMPLE_NB4_ADDR A:0x437407c
y.create.l HWIO_RXFE_NB_NBPWR_START_MASK_NB4_ADDR A:0x4374080
y.create.l HWIO_RXFE_NB_NBPWR_STOP_ACTION_SAMPLE_NB4_ADDR A:0x4374084
y.create.l HWIO_RXFE_NB_NBPWR_FINAL_ACC_NB4_ADDR A:0x4374088
y.create.l HWIO_RXFE_NB_NBPWR_CURR_ACC_NB4_ADDR A:0x437408c
y.create.l HWIO_RXFE_NB_NBPWR_MAX_ACC_NB4_ADDR A:0x4374090
y.create.l HWIO_RXFE_NB_DVGA_CFG_NB4_ADDR A:0x4374094
y.create.l HWIO_RXFE_NB_DVGA_RXFE_GAIN_NB4_ADDR A:0x4374098
y.create.l HWIO_RXFE_NB_DVGA_OVERRIDE_DVGA_GAIN_NB4_ADDR A:0x437409c
y.create.l HWIO_RXFE_NB_DVGA_CMD_NB4_ADDR A:0x43740a0
y.create.l HWIO_RXFE_NB_DVGA_UPDT_ACTION_SAMPLE_NB4_ADDR A:0x43740a4
y.create.l HWIO_RXFE_NB_DVGA_UPDT_MASK_NB4_ADDR A:0x43740a8
y.create.l HWIO_RXFE_NB_FINAL_BITWIDTHS_CFG_NB4_ADDR A:0x43740ac
y.create.l HWIO_RXFE_NB_FINAL_SWAP_NB4_ADDR A:0x43740dc
y.create.l HWIO_RXFE_NB_WTR_CFG_NB4_ADDR A:0x43740b0
y.create.l HWIO_RXFE_NB_WTR_FUNC_CFG_NB4_ADDR A:0x43740b4
y.create.l HWIO_RXFE_NB_WTR_DBG_CFG0_NB4_ADDR A:0x43740b8
y.create.l HWIO_RXFE_NB_WTR_DBG_CFG1_NB4_ADDR A:0x43740bc
y.create.l HWIO_RXFE_NB_WTR_CMD_NB4_ADDR A:0x43740c0
y.create.l HWIO_RXFE_NB_WTR_START_ACTION_SAMPLE_NB4_ADDR A:0x43740c4
y.create.l HWIO_RXFE_NB_WTR_STOP_ACTION_SAMPLE_NB4_ADDR A:0x43740c8
y.create.l HWIO_RXFE_NB_WTR_STATUS_NB4_ADDR A:0x43740d0
y.create.l HWIO_RXFE_NB_WTR_ADDR_SNAPSHOT_NB4_ADDR A:0x43740d4
y.create.l HWIO_RXFE_NB_SPARE_REG_NB4_ADDR A:0x43740d8
y.create.l HWIO_RXFE_NB_TOP_CTL_NB5_ADDR A:0x4375000
y.create.l HWIO_RXFE_NB_GATE_CMD_NB5_ADDR A:0x4375004
y.create.l HWIO_RXFE_NB_GATE_STATUS_NB5_ADDR A:0x4375008
y.create.l HWIO_RXFE_NB_GATE_ACTION_SAMPLE_NB5_ADDR A:0x437500c
y.create.l HWIO_RXFE_NB_TIMINGCTL_STATUS_NB5_ADDR A:0x4375010
y.create.l HWIO_RXFE_NB_CSR_CFG_NB5_ADDR A:0x4375014
y.create.l HWIO_RXFE_NB_CSR_CMD_NB5_ADDR A:0x4375018
y.create.l HWIO_RXFE_NB_CSR_PHASEUPDT_ACTION_SAMPLE_NB5_ADDR A:0x437501c
y.create.l HWIO_RXFE_NB_CSR_FREQUPDT_ACTION_SAMPLE_NB5_ADDR A:0x4375020
y.create.l HWIO_RXFE_NB_CSR_PHASE_OFFSET_NB5_ADDR A:0x4375024
y.create.l HWIO_RXFE_NB_CSR_FREQ_OFFSET_NB5_ADDR A:0x4375028
y.create.l HWIO_RXFE_NB_CSR_CURR_PHASE_OFFSET_NB5_ADDR A:0x437502c
y.create.l HWIO_RXFE_NB_CSR_CURR_FREQ_OFFSET_NB5_ADDR A:0x4375030
y.create.l HWIO_RXFE_NB_FILTERS_CFG_NB5_ADDR A:0x4375034
y.create.l HWIO_RXFE_NB_ICI_COEF0_NB5_ADDR A:0x437503c
y.create.l HWIO_RXFE_NB_ICI_COEF1_NB5_ADDR A:0x4375040
y.create.l HWIO_RXFE_NB_ICI_COEF2_NB5_ADDR A:0x4375044
y.create.l HWIO_RXFE_NB_ICI_COEF3_NB5_ADDR A:0x4375048
y.create.l HWIO_RXFE_NB_ICI_COEF4_NB5_ADDR A:0x437504c
y.create.l HWIO_RXFE_NB_ICI_COEF5_NB5_ADDR A:0x4375050
y.create.l HWIO_RXFE_NB_ICI_COEF6_NB5_ADDR A:0x4375054
y.create.l HWIO_RXFE_NB_ICI_COEF7_NB5_ADDR A:0x4375058
y.create.l HWIO_RXFE_NB_ICI_COEF8_NB5_ADDR A:0x437505c
y.create.l HWIO_RXFE_NB_ICI_COEF9_NB5_ADDR A:0x4375060
y.create.l HWIO_RXFE_NB_GDA_NB5_ADDR A:0x4375068
y.create.l HWIO_RXFE_NB_NBDC_COMPVAL_I_NB5_ADDR A:0x437506c
y.create.l HWIO_RXFE_NB_NBDC_COMPVAL_Q_NB5_ADDR A:0x4375070
y.create.l HWIO_RXFE_NB_NBPWR_CFG_NB5_ADDR A:0x4375074
y.create.l HWIO_RXFE_NB_NBPWR_CMD_NB5_ADDR A:0x4375078
y.create.l HWIO_RXFE_NB_NBPWR_START_ACTION_SAMPLE_NB5_ADDR A:0x437507c
y.create.l HWIO_RXFE_NB_NBPWR_START_MASK_NB5_ADDR A:0x4375080
y.create.l HWIO_RXFE_NB_NBPWR_STOP_ACTION_SAMPLE_NB5_ADDR A:0x4375084
y.create.l HWIO_RXFE_NB_NBPWR_FINAL_ACC_NB5_ADDR A:0x4375088
y.create.l HWIO_RXFE_NB_NBPWR_CURR_ACC_NB5_ADDR A:0x437508c
y.create.l HWIO_RXFE_NB_NBPWR_MAX_ACC_NB5_ADDR A:0x4375090
y.create.l HWIO_RXFE_NB_DVGA_CFG_NB5_ADDR A:0x4375094
y.create.l HWIO_RXFE_NB_DVGA_RXFE_GAIN_NB5_ADDR A:0x4375098
y.create.l HWIO_RXFE_NB_DVGA_OVERRIDE_DVGA_GAIN_NB5_ADDR A:0x437509c
y.create.l HWIO_RXFE_NB_DVGA_CMD_NB5_ADDR A:0x43750a0
y.create.l HWIO_RXFE_NB_DVGA_UPDT_ACTION_SAMPLE_NB5_ADDR A:0x43750a4
y.create.l HWIO_RXFE_NB_DVGA_UPDT_MASK_NB5_ADDR A:0x43750a8
y.create.l HWIO_RXFE_NB_FINAL_BITWIDTHS_CFG_NB5_ADDR A:0x43750ac
y.create.l HWIO_RXFE_NB_FINAL_SWAP_NB5_ADDR A:0x43750dc
y.create.l HWIO_RXFE_NB_WTR_CFG_NB5_ADDR A:0x43750b0
y.create.l HWIO_RXFE_NB_WTR_FUNC_CFG_NB5_ADDR A:0x43750b4
y.create.l HWIO_RXFE_NB_WTR_DBG_CFG0_NB5_ADDR A:0x43750b8
y.create.l HWIO_RXFE_NB_WTR_DBG_CFG1_NB5_ADDR A:0x43750bc
y.create.l HWIO_RXFE_NB_WTR_CMD_NB5_ADDR A:0x43750c0
y.create.l HWIO_RXFE_NB_WTR_START_ACTION_SAMPLE_NB5_ADDR A:0x43750c4
y.create.l HWIO_RXFE_NB_WTR_STOP_ACTION_SAMPLE_NB5_ADDR A:0x43750c8
y.create.l HWIO_RXFE_NB_WTR_STATUS_NB5_ADDR A:0x43750d0
y.create.l HWIO_RXFE_NB_WTR_ADDR_SNAPSHOT_NB5_ADDR A:0x43750d4
y.create.l HWIO_RXFE_NB_SPARE_REG_NB5_ADDR A:0x43750d8
y.create.l HWIO_RXFE_WRTR0_CFG0_ADDR A:0x437f000
y.create.l HWIO_RXFE_WRTR1_CFG0_ADDR A:0x437f008
y.create.l HWIO_RXFE_WRTR2_CFG0_ADDR A:0x437f010
y.create.l HWIO_RXFE_WRTR3_CFG0_ADDR A:0x437f018
y.create.l HWIO_RXFE_WRTR4_CFG0_ADDR A:0x437f020
y.create.l HWIO_RXFE_WRTR5_CFG0_ADDR A:0x437f028
y.create.l HWIO_RXFE_WRTR0_CFG1_ADDR A:0x437f004
y.create.l HWIO_RXFE_WRTR1_CFG1_ADDR A:0x437f00c
y.create.l HWIO_RXFE_WRTR2_CFG1_ADDR A:0x437f014
y.create.l HWIO_RXFE_WRTR3_CFG1_ADDR A:0x437f01c
y.create.l HWIO_RXFE_WRTR4_CFG1_ADDR A:0x437f024
y.create.l HWIO_RXFE_WRTR5_CFG1_ADDR A:0x437f02c
y.create.l HWIO_RXFE_WRTR_XFER_CTL_ADDR A:0x437f040
y.create.l HWIO_RXFE_BRDG_CTL_ADDR A:0x437f044
y.create.l HWIO_RXFE_BRDG_STATUS_ADDR A:0x437f048
y.create.l HWIO_RXFE_BRDG_CLEAR_ADDR A:0x437f04c
y.create.l HWIO_RXFE_BRDG_ARB_PRI_ADDR A:0x437f050
y.create.l HWIO_RXFE_BRDG_AXI_PRI_ADDR A:0x437f054
y.create.l HWIO_RXFE_BRDG_AXI_IDLE_CNT0_ADDR A:0x437f058
y.create.l HWIO_RXFE_BRDG_AXI_IDLE_CNT1_ADDR A:0x437f060
y.create.l HWIO_RXFE_BRDG_AXI_IDLE_CNT2_ADDR A:0x437f068
y.create.l HWIO_RXFE_BRDG_AXI_IDLE_CNT3_ADDR A:0x437f070
y.create.l HWIO_RXFE_BRDG_AXI_IDLE_CNT4_ADDR A:0x437f078
y.create.l HWIO_RXFE_BRDG_AXI_IDLE_CNT5_ADDR A:0x437f080
y.create.l HWIO_DEMBACK_EN_ADDR A:0x4340000
y.create.l HWIO_DEMBACK_MODE_SEL_ADDR A:0x4340004
y.create.l HWIO_DEMBACK_AHB_ERR_ADDR A:0x4340008
y.create.l HWIO_DEMBACK_MISC_ERR_DET_ADDR A:0x4340010
y.create.l HWIO_DEMBACK_MISC_ERR_CLR_ADDR A:0x4340014
y.create.l HWIO_DEMBACK_RDR0_XFER_CTL_ADDR A:0x4340100
y.create.l HWIO_DEMBACK_RDR0_CTX0_CFG0_ADDR A:0x4340108
y.create.l HWIO_DEMBACK_RDR0_CTX0_CFG1_ADDR A:0x434010c
y.create.l HWIO_DEMBACK_RDR0_CTX1_CFG0_ADDR A:0x4340110
y.create.l HWIO_DEMBACK_RDR0_CTX1_CFG1_ADDR A:0x4340114
y.create.l HWIO_DEMBACK_RDR0_CTX2_CFG0_ADDR A:0x4340118
y.create.l HWIO_DEMBACK_RDR0_CTX2_CFG1_ADDR A:0x434011c
y.create.l HWIO_DEMBACK_RDR0_CTX3_CFG0_ADDR A:0x4340120
y.create.l HWIO_DEMBACK_RDR0_CTX3_CFG1_ADDR A:0x4340124
y.create.l HWIO_DEMBACK_RDR1_XFER_CTL_ADDR A:0x4340148
y.create.l HWIO_DEMBACK_RDR1_CFG0_ADDR A:0x434014c
y.create.l HWIO_DEMBACK_RDR1_CFG1_ADDR A:0x4340150
y.create.l HWIO_DEMBACK_RDR2_XFER_CTL_ADDR A:0x4340154
y.create.l HWIO_DEMBACK_RDR2_CFG0_ADDR A:0x4340158
y.create.l HWIO_DEMBACK_RDR2_CFG1_ADDR A:0x434015c
y.create.l HWIO_DEMBACK_BRDG_CTL_ADDR A:0x4340190
y.create.l HWIO_DEMBACK_BRDG_STATUS_ADDR A:0x4340194
y.create.l HWIO_DEMBACK_BRDG_CLEAR_ADDR A:0x4340198
y.create.l HWIO_DEMBACK_BRDG_AXI_PRI_ADDR A:0x43401a0
y.create.l HWIO_DEMBACK_DBG_CTL_ADDR A:0x43401ac
y.create.l HWIO_LTE_DBE_PHICH_STATUS_ADDR A:0x4341000
y.create.l HWIO_LTE_DBE_PCFICH_STATUS_ADDR A:0x4341004
y.create.l HWIO_LTE_DBE_SCRAMBLE_SEED_FF_X1_SEED_ADDR A:0x4341008
y.create.l HWIO_LTE_DBE_TESTBUS_ENABLE_ADDR A:0x434100c
y.create.l HWIO_LTE_DBE_TESTBUS_STATUS_ADDR A:0x4341010
y.create.l HWIO_LTE_DBE_PBCH_CMD_COUNT_ADDR A:0x4341014
y.create.l HWIO_LTE_DBE_PDCCH_CMD_COUNT_ADDR A:0x4341018
y.create.l HWIO_LTE_DBE_PDSCH_CMD_COUNT_ADDR A:0x434101c
y.create.l HWIO_LTE_DBE_PBCH_DONE_COUNT_ADDR A:0x4341020
y.create.l HWIO_LTE_DBE_PDCCH_DONE_COUNT_ADDR A:0x4341024
y.create.l HWIO_LTE_DBE_PDSCH_DONE_COUNT_ADDR A:0x4341028
y.create.l HWIO_LTE_CFG_ADDR A:0x434102c
y.create.l HWIO_DBACK_AMP_EST0_0_ADDR A:0x4342000
y.create.l HWIO_DBACK_AMP_EST0_1_ADDR A:0x4342008
y.create.l HWIO_DBACK_AMP_EST0_2_ADDR A:0x4342010
y.create.l HWIO_DBACK_AMP_EST0_3_ADDR A:0x4342018
y.create.l HWIO_DBACK_AMP_EST0_4_ADDR A:0x4342020
y.create.l HWIO_DBACK_AMP_EST0_5_ADDR A:0x4342028
y.create.l HWIO_DBACK_ENG_EST0_0_ADDR A:0x4342004
y.create.l HWIO_DBACK_ENG_EST0_1_ADDR A:0x434200c
y.create.l HWIO_DBACK_ENG_EST0_2_ADDR A:0x4342014
y.create.l HWIO_DBACK_ENG_EST0_3_ADDR A:0x434201c
y.create.l HWIO_DBACK_ENG_EST0_4_ADDR A:0x4342024
y.create.l HWIO_DBACK_ENG_EST0_5_ADDR A:0x434202c
y.create.l HWIO_DBACK_AMP_EST1_0_ADDR A:0x4342030
y.create.l HWIO_DBACK_AMP_EST1_1_ADDR A:0x4342038
y.create.l HWIO_DBACK_AMP_EST1_2_ADDR A:0x4342040
y.create.l HWIO_DBACK_AMP_EST1_3_ADDR A:0x4342048
y.create.l HWIO_DBACK_AMP_EST1_4_ADDR A:0x4342050
y.create.l HWIO_DBACK_AMP_EST1_5_ADDR A:0x4342058
y.create.l HWIO_DBACK_ENG_EST1_0_ADDR A:0x4342034
y.create.l HWIO_DBACK_ENG_EST1_1_ADDR A:0x434203c
y.create.l HWIO_DBACK_ENG_EST1_2_ADDR A:0x4342044
y.create.l HWIO_DBACK_ENG_EST1_3_ADDR A:0x434204c
y.create.l HWIO_DBACK_ENG_EST1_4_ADDR A:0x4342054
y.create.l HWIO_DBACK_ENG_EST1_5_ADDR A:0x434205c
y.create.l HWIO_DBACK_HS_CH0_PART1_DEC_DATA0_ADDR A:0x4342060
y.create.l HWIO_DBACK_HS_CH1_PART1_DEC_DATA0_ADDR A:0x434206c
y.create.l HWIO_DBACK_HS_CH2_PART1_DEC_DATA0_ADDR A:0x4342078
y.create.l HWIO_DBACK_HS_CH3_PART1_DEC_DATA0_ADDR A:0x4342084
y.create.l HWIO_DBACK_HS_CH4_PART1_DEC_DATA0_ADDR A:0x4342090
y.create.l HWIO_DBACK_HS_CH5_PART1_DEC_DATA0_ADDR A:0x434209c
y.create.l HWIO_DBACK_HS_CH6_PART1_DEC_DATA0_ADDR A:0x43420a8
y.create.l HWIO_DBACK_HS_CH7_PART1_DEC_DATA0_ADDR A:0x43420b4
y.create.l HWIO_DBACK_HS_CH8_PART1_DEC_DATA0_ADDR A:0x43420c0
y.create.l HWIO_DBACK_HS_CH9_PART1_DEC_DATA0_ADDR A:0x43420cc
y.create.l HWIO_DBACK_HS_CH0_PART1_DEC_STAT_ADDR A:0x4342064
y.create.l HWIO_DBACK_HS_CH1_PART1_DEC_STAT_ADDR A:0x4342070
y.create.l HWIO_DBACK_HS_CH2_PART1_DEC_STAT_ADDR A:0x434207c
y.create.l HWIO_DBACK_HS_CH3_PART1_DEC_STAT_ADDR A:0x4342088
y.create.l HWIO_DBACK_HS_CH4_PART1_DEC_STAT_ADDR A:0x4342094
y.create.l HWIO_DBACK_HS_CH5_PART1_DEC_STAT_ADDR A:0x43420a0
y.create.l HWIO_DBACK_HS_CH6_PART1_DEC_STAT_ADDR A:0x43420ac
y.create.l HWIO_DBACK_HS_CH7_PART1_DEC_STAT_ADDR A:0x43420b8
y.create.l HWIO_DBACK_HS_CH8_PART1_DEC_STAT_ADDR A:0x43420c4
y.create.l HWIO_DBACK_HS_CH9_PART1_DEC_STAT_ADDR A:0x43420d0
y.create.l HWIO_DBACK_HS_CH0_SLOT1_AE_EST_ADDR A:0x4342068
y.create.l HWIO_DBACK_HS_CH1_SLOT1_AE_EST_ADDR A:0x4342074
y.create.l HWIO_DBACK_HS_CH2_SLOT1_AE_EST_ADDR A:0x4342080
y.create.l HWIO_DBACK_HS_CH3_SLOT1_AE_EST_ADDR A:0x434208c
y.create.l HWIO_DBACK_HS_CH4_SLOT1_AE_EST_ADDR A:0x4342098
y.create.l HWIO_DBACK_HS_CH5_SLOT1_AE_EST_ADDR A:0x43420a4
y.create.l HWIO_DBACK_HS_CH6_SLOT1_AE_EST_ADDR A:0x43420b0
y.create.l HWIO_DBACK_HS_CH7_SLOT1_AE_EST_ADDR A:0x43420bc
y.create.l HWIO_DBACK_HS_CH8_SLOT1_AE_EST_ADDR A:0x43420c8
y.create.l HWIO_DBACK_HS_CH9_SLOT1_AE_EST_ADDR A:0x43420d4
y.create.l HWIO_DBACK_HS_CH0_PART2_DEC_DATA1_ADDR A:0x43420d8
y.create.l HWIO_DBACK_HS_CH1_PART2_DEC_DATA1_ADDR A:0x43420e8
y.create.l HWIO_DBACK_HS_CH2_PART2_DEC_DATA1_ADDR A:0x43420f8
y.create.l HWIO_DBACK_HS_CH3_PART2_DEC_DATA1_ADDR A:0x4342108
y.create.l HWIO_DBACK_HS_CH4_PART2_DEC_DATA1_ADDR A:0x4342118
y.create.l HWIO_DBACK_HS_CH5_PART2_DEC_DATA1_ADDR A:0x4342128
y.create.l HWIO_DBACK_HS_CH6_PART2_DEC_DATA1_ADDR A:0x4342138
y.create.l HWIO_DBACK_HS_CH7_PART2_DEC_DATA1_ADDR A:0x4342148
y.create.l HWIO_DBACK_HS_CH8_PART2_DEC_DATA1_ADDR A:0x4342158
y.create.l HWIO_DBACK_HS_CH9_PART2_DEC_DATA1_ADDR A:0x4342168
y.create.l HWIO_DBACK_HS_CH0_PART2_DEC_STAT_ADDR A:0x43420dc
y.create.l HWIO_DBACK_HS_CH1_PART2_DEC_STAT_ADDR A:0x43420ec
y.create.l HWIO_DBACK_HS_CH2_PART2_DEC_STAT_ADDR A:0x43420fc
y.create.l HWIO_DBACK_HS_CH3_PART2_DEC_STAT_ADDR A:0x434210c
y.create.l HWIO_DBACK_HS_CH4_PART2_DEC_STAT_ADDR A:0x434211c
y.create.l HWIO_DBACK_HS_CH5_PART2_DEC_STAT_ADDR A:0x434212c
y.create.l HWIO_DBACK_HS_CH6_PART2_DEC_STAT_ADDR A:0x434213c
y.create.l HWIO_DBACK_HS_CH7_PART2_DEC_STAT_ADDR A:0x434214c
y.create.l HWIO_DBACK_HS_CH8_PART2_DEC_STAT_ADDR A:0x434215c
y.create.l HWIO_DBACK_HS_CH9_PART2_DEC_STAT_ADDR A:0x434216c
y.create.l HWIO_DBACK_HS_CH0_SLOT2_AE_EST_ADDR A:0x43420e0
y.create.l HWIO_DBACK_HS_CH1_SLOT2_AE_EST_ADDR A:0x43420f0
y.create.l HWIO_DBACK_HS_CH2_SLOT2_AE_EST_ADDR A:0x4342100
y.create.l HWIO_DBACK_HS_CH3_SLOT2_AE_EST_ADDR A:0x4342110
y.create.l HWIO_DBACK_HS_CH4_SLOT2_AE_EST_ADDR A:0x4342120
y.create.l HWIO_DBACK_HS_CH5_SLOT2_AE_EST_ADDR A:0x4342130
y.create.l HWIO_DBACK_HS_CH6_SLOT2_AE_EST_ADDR A:0x4342140
y.create.l HWIO_DBACK_HS_CH7_SLOT2_AE_EST_ADDR A:0x4342150
y.create.l HWIO_DBACK_HS_CH8_SLOT2_AE_EST_ADDR A:0x4342160
y.create.l HWIO_DBACK_HS_CH9_SLOT2_AE_EST_ADDR A:0x4342170
y.create.l HWIO_DBACK_HS_CH0_SLOT3_AE_EST_ADDR A:0x43420e4
y.create.l HWIO_DBACK_HS_CH1_SLOT3_AE_EST_ADDR A:0x43420f4
y.create.l HWIO_DBACK_HS_CH2_SLOT3_AE_EST_ADDR A:0x4342104
y.create.l HWIO_DBACK_HS_CH3_SLOT3_AE_EST_ADDR A:0x4342114
y.create.l HWIO_DBACK_HS_CH4_SLOT3_AE_EST_ADDR A:0x4342124
y.create.l HWIO_DBACK_HS_CH5_SLOT3_AE_EST_ADDR A:0x4342134
y.create.l HWIO_DBACK_HS_CH6_SLOT3_AE_EST_ADDR A:0x4342144
y.create.l HWIO_DBACK_HS_CH7_SLOT3_AE_EST_ADDR A:0x4342154
y.create.l HWIO_DBACK_HS_CH8_SLOT3_AE_EST_ADDR A:0x4342164
y.create.l HWIO_DBACK_HS_CH9_SLOT3_AE_EST_ADDR A:0x4342174
y.create.l HWIO_DBACK_EAGCH_DEC_DATA_ADDR A:0x4342178
y.create.l HWIO_DBACK_EAGCH_DEC_STAT_ADDR A:0x434217c
y.create.l HWIO_DBACK_EAGCH_METRIC_ADDR A:0x4342180
y.create.l HWIO_DBACK_HSSCCH_CTL1_ADDR A:0x4342184
y.create.l HWIO_DBACK_HSSCCH_CTL2_ADDR A:0x4342188
y.create.l HWIO_HS_SCCH_PART2_DECODE_MAP_ADDR A:0x434218c
y.create.l HWIO_DBACK_CH0_UEID_MASK_0_ADDR A:0x4342190
y.create.l HWIO_DBACK_CH1_UEID_MASK_0_ADDR A:0x4342194
y.create.l HWIO_DBACK_CH2_UEID_MASK_0_ADDR A:0x4342198
y.create.l HWIO_DBACK_CH3_UEID_MASK_0_ADDR A:0x434219c
y.create.l HWIO_DBACK_CH4_UEID_MASK_0_ADDR A:0x43421a0
y.create.l HWIO_DBACK_CH5_UEID_MASK_0_ADDR A:0x43421a4
y.create.l HWIO_DBACK_CH6_UEID_MASK_0_ADDR A:0x43421a8
y.create.l HWIO_DBACK_CH7_UEID_MASK_0_ADDR A:0x43421ac
y.create.l HWIO_DBACK_CH8_UEID_MASK_0_ADDR A:0x43421b0
y.create.l HWIO_DBACK_CH9_UEID_MASK_0_ADDR A:0x43421b4
y.create.l HWIO_DBACK_CH0_UEID_MASK_1_ADDR A:0x43421b8
y.create.l HWIO_DBACK_CH1_UEID_MASK_1_ADDR A:0x43421bc
y.create.l HWIO_DBACK_CH2_UEID_MASK_1_ADDR A:0x43421c0
y.create.l HWIO_DBACK_CH3_UEID_MASK_1_ADDR A:0x43421c4
y.create.l HWIO_DBACK_CH4_UEID_MASK_1_ADDR A:0x43421c8
y.create.l HWIO_DBACK_CH5_UEID_MASK_1_ADDR A:0x43421cc
y.create.l HWIO_DBACK_CH6_UEID_MASK_1_ADDR A:0x43421d0
y.create.l HWIO_DBACK_CH7_UEID_MASK_1_ADDR A:0x43421d4
y.create.l HWIO_DBACK_CH8_UEID_MASK_1_ADDR A:0x43421d8
y.create.l HWIO_DBACK_CH9_UEID_MASK_1_ADDR A:0x43421dc
y.create.l HWIO_DBACK_HSSCCH_PART1_TRIGGER_ADDR A:0x43421e0
y.create.l HWIO_DBACK_HSSCCH_YAM_THRES_ADDR A:0x43421e4
y.create.l HWIO_DBACK_HSSCCH_PART2_TRIGGER_ADDR A:0x43421e8
y.create.l HWIO_DBACK_HSSCCH_STATUS_ADDR A:0x43421ec
y.create.l HWIO_DBACK_EAGCH_CONFIG_ADDR A:0x43421f0
y.create.l HWIO_DBACK_EAGCH_CTL_ADDR A:0x43421f4
y.create.l HWIO_DBACK_EAGCH_TRIGGER_ADDR A:0x43421f8
y.create.l HWIO_DBACK_EAGCH_RM_PATTERN_0_ADDR A:0x43421fc
y.create.l HWIO_DBACK_EAGCH_RM_PATTERN_1_ADDR A:0x4342200
y.create.l HWIO_DBACK_EAGCH_RM_PATTERN_2_ADDR A:0x4342204
y.create.l HWIO_DBACK_HS_EUL_CTL_CH_RST_ADDR A:0x4342208
y.create.l HWIO_DBACK_NONHS_WCB_SIZE_ADDR A:0x434220c
y.create.l HWIO_DBACK_HS_WCB_SIZE_ADDR A:0x4342210
y.create.l HWIO_DBACK_PART1_INT_STATUS_ADDR A:0x4342214
y.create.l HWIO_DBACK_PART1_INT_CLR_ADDR A:0x4342218
y.create.l HWIO_DBACK_PART1_INT_EN_ADDR A:0x434221c
y.create.l HWIO_DBACK_PART2_INT_STATUS_ADDR A:0x4342220
y.create.l HWIO_DBACK_PART2_INT_CLR_ADDR A:0x4342224
y.create.l HWIO_DBACK_PART2_INT_EN_ADDR A:0x4342228
y.create.l HWIO_DBACK_EAGCH_INT_EN_ADDR A:0x434222c
y.create.l HWIO_DBACK_TEST_MEM_SEL_ADDR A:0x4342230
y.create.l HWIO_DBACK_TEST_BUS_SEL_ADDR A:0x4342234
y.create.l HWIO_DBACK_MEM_ADDR_ADDR A:0x4342238
y.create.l HWIO_DBACK_MEM_DATA0_ADDR A:0x434223c
y.create.l HWIO_DBACK_MEM_DATA1_ADDR A:0x4342240
y.create.l HWIO_DBACK_MEM_DATA2_ADDR A:0x4342244
y.create.l HWIO_DBACK_MEM_DATA3_ADDR A:0x4342248
y.create.l HWIO_DBACK_MEM_DATA4_ADDR A:0x434224c
y.create.l HWIO_T_DBACK_HS_CH0_DEC_DATA0_ADDR A:0x4342400
y.create.l HWIO_T_DBACK_HS_CH1_DEC_DATA0_ADDR A:0x434240c
y.create.l HWIO_T_DBACK_HS_CH2_DEC_DATA0_ADDR A:0x4342418
y.create.l HWIO_T_DBACK_HS_CH3_DEC_DATA0_ADDR A:0x4342424
y.create.l HWIO_T_DBACK_HS_CH0_DEC_DATA1_ADDR A:0x4342404
y.create.l HWIO_T_DBACK_HS_CH1_DEC_DATA1_ADDR A:0x4342410
y.create.l HWIO_T_DBACK_HS_CH2_DEC_DATA1_ADDR A:0x434241c
y.create.l HWIO_T_DBACK_HS_CH3_DEC_DATA1_ADDR A:0x4342428
y.create.l HWIO_T_DBACK_HS_CH0_DEC_STAT_ADDR A:0x4342408
y.create.l HWIO_T_DBACK_HS_CH1_DEC_STAT_ADDR A:0x4342414
y.create.l HWIO_T_DBACK_HS_CH2_DEC_STAT_ADDR A:0x4342420
y.create.l HWIO_T_DBACK_HS_CH3_DEC_STAT_ADDR A:0x434242c
y.create.l HWIO_T_DBACK_EAGCH0_DEC_DATA0_ADDR A:0x4342430
y.create.l HWIO_T_DBACK_EAGCH1_DEC_DATA0_ADDR A:0x4342440
y.create.l HWIO_T_DBACK_EAGCH2_DEC_DATA0_ADDR A:0x4342450
y.create.l HWIO_T_DBACK_EAGCH3_DEC_DATA0_ADDR A:0x4342460
y.create.l HWIO_T_DBACK_EAGCH0_DEC_DATA1_ADDR A:0x4342434
y.create.l HWIO_T_DBACK_EAGCH1_DEC_DATA1_ADDR A:0x4342444
y.create.l HWIO_T_DBACK_EAGCH2_DEC_DATA1_ADDR A:0x4342454
y.create.l HWIO_T_DBACK_EAGCH3_DEC_DATA1_ADDR A:0x4342464
y.create.l HWIO_T_DBACK_EAGCH0_DEC_STAT_ADDR A:0x4342438
y.create.l HWIO_T_DBACK_EAGCH1_DEC_STAT_ADDR A:0x4342448
y.create.l HWIO_T_DBACK_EAGCH2_DEC_STAT_ADDR A:0x4342458
y.create.l HWIO_T_DBACK_EAGCH3_DEC_STAT_ADDR A:0x4342468
y.create.l HWIO_T_DBACK_EAGCH0_METRIC_ADDR A:0x434243c
y.create.l HWIO_T_DBACK_EAGCH1_METRIC_ADDR A:0x434244c
y.create.l HWIO_T_DBACK_EAGCH2_METRIC_ADDR A:0x434245c
y.create.l HWIO_T_DBACK_EAGCH3_METRIC_ADDR A:0x434246c
y.create.l HWIO_T_DBACK_FPACH_DEC_DATA0_ADDR A:0x4342470
y.create.l HWIO_T_DBACK_FPACH_DEC_DATA1_ADDR A:0x4342474
y.create.l HWIO_T_DBACK_FPACH_DEC_STAT_ADDR A:0x4342478
y.create.l HWIO_T_DBACK_TEST_MEM_SEL_ADDR A:0x434247c
y.create.l HWIO_T_DBACK_TEST_BUS_SEL_ADDR A:0x4342480
y.create.l HWIO_T_DBACK_MEM_ADDR_ADDR A:0x4342484
y.create.l HWIO_T_DBACK_MEM_DATA0_ADDR A:0x4342488
y.create.l HWIO_T_DBACK_MEM_DATA1_ADDR A:0x434248c
y.create.l HWIO_T_DBACK_MEM_DATA2_ADDR A:0x4342490
y.create.l HWIO_T_DBACK_MEM_DATA3_ADDR A:0x4342494
y.create.l HWIO_T_DBACK_MEM_DATA4_ADDR A:0x4342498
y.create.l HWIO_T_DBACK_HS_CH0_DC_DEC_DATA0_ADDR A:0x434249c
y.create.l HWIO_T_DBACK_HS_CH1_DC_DEC_DATA0_ADDR A:0x43424a8
y.create.l HWIO_T_DBACK_HS_CH2_DC_DEC_DATA0_ADDR A:0x43424b4
y.create.l HWIO_T_DBACK_HS_CH3_DC_DEC_DATA0_ADDR A:0x43424c0
y.create.l HWIO_T_DBACK_HS_CH0_DC_DEC_DATA1_ADDR A:0x43424a0
y.create.l HWIO_T_DBACK_HS_CH1_DC_DEC_DATA1_ADDR A:0x43424ac
y.create.l HWIO_T_DBACK_HS_CH2_DC_DEC_DATA1_ADDR A:0x43424b8
y.create.l HWIO_T_DBACK_HS_CH3_DC_DEC_DATA1_ADDR A:0x43424c4
y.create.l HWIO_T_DBACK_HS_CH0_DC_DEC_STAT_ADDR A:0x43424a4
y.create.l HWIO_T_DBACK_HS_CH1_DC_DEC_STAT_ADDR A:0x43424b0
y.create.l HWIO_T_DBACK_HS_CH2_DC_DEC_STAT_ADDR A:0x43424bc
y.create.l HWIO_T_DBACK_HS_CH3_DC_DEC_STAT_ADDR A:0x43424c8
y.create.l HWIO_DINT_CFG_ADDR A:0x4342600
y.create.l HWIO_DINT_CH0_CFG_ADDR A:0x4342604
y.create.l HWIO_DINT_CH1_CFG_ADDR A:0x4342608
y.create.l HWIO_DINT_CH2_CFG_ADDR A:0x434260c
y.create.l HWIO_TD_BLOCK_SIZE_ADDR A:0x4342614
y.create.l HWIO_TD_INTLV_CFG_LO_ADDR A:0x4342618
y.create.l HWIO_TD_INTLV_CFG_HI_ADDR A:0x434261c
y.create.l HWIO_TD_INTLV_SIZE_LO_ADDR A:0x4342620
y.create.l HWIO_TD_PUNCT_LO_ADDR A:0x4342624
y.create.l HWIO_TD_PUNCT_HI_ADDR A:0x4342628
y.create.l HWIO_DINT_PKT_OFFSET_ADDR A:0x4342630
y.create.l HWIO_DINT_PKT_CFG_ADDR A:0x4342634
y.create.l HWIO_DINT_TASK_OFFSET_ADDR A:0x4342638
y.create.l HWIO_DINT_TASK_LIST_ADDR A:0x434263c
y.create.l HWIO_TST_SYNC_DINT_ADDR A:0x4342640
y.create.l HWIO_TST_CH0_SYMS_ADDR A:0x4342644
y.create.l HWIO_TST_CH1_SYMS_ADDR A:0x4342648
y.create.l HWIO_TST_CH2_SYMS_ADDR A:0x434264c
y.create.l HWIO_TST_SEL_DINT_ADDR A:0x4342654
y.create.l HWIO_DINT_OTD_CFG_ADDR A:0x4342658
y.create.l HWIO_TST_SYS_TIME_ADDR A:0x4342670
y.create.l HWIO_DEINT_DBG_BUS_CTL_ADDR A:0x4342674
y.create.l HWIO_DEC_CLR_INT_STATUS_ADDR A:0x4342684
y.create.l HWIO_DEINT_CLK_STATUS_ADDR A:0x4342688
y.create.l HWIO_DEC_DONE_INT_STATUS_ADDR A:0x434268c
y.create.l HWIO_DEINT_TASK_STATUS_ADDR A:0x4342690
y.create.l HWIO_DEINT_FRMHYP_STATUS_ADDR A:0x4342694
y.create.l HWIO_DINT_VD_RD_ADDR_ADDR A:0x4342698
y.create.l HWIO_DINT_FCH_CFG0_ADDR A:0x434269c
y.create.l HWIO_DINT_FCH_CFG1_ADDR A:0x43426a0
y.create.l HWIO_DINT_FCH_TRIGGER_ADDR A:0x43426a4
y.create.l HWIO_DINT_FCH_WR_BANK_ADDR A:0x43426a8
y.create.l HWIO_DINT_FCH_EGTH_HYP_CFG0_ADDR A:0x43426ac
y.create.l HWIO_DINT_FCH_EGTH_HYP_CFG1_ADDR A:0x43426b0
y.create.l HWIO_DINT_FCH_EGTH_HYP_CFG2_ADDR A:0x43426b4
y.create.l HWIO_DINT_FCH_EGTH_HYP_CFG3_ADDR A:0x43426b8
y.create.l HWIO_DINT_FCH_QRTR_HYP_CFG0_ADDR A:0x43426bc
y.create.l HWIO_DINT_FCH_QRTR_HYP_CFG1_ADDR A:0x43426c0
y.create.l HWIO_DINT_FCH_QRTR_HYP_CFG2_ADDR A:0x43426c4
y.create.l HWIO_DINT_FCH_QRTR_HYP_CFG3_ADDR A:0x43426c8
y.create.l HWIO_DINT_FCH_HALF_HYP_CFG0_ADDR A:0x43426cc
y.create.l HWIO_DINT_FCH_HALF_HYP_CFG1_ADDR A:0x43426d0
y.create.l HWIO_DINT_FCH_HALF_HYP_CFG2_ADDR A:0x43426d4
y.create.l HWIO_DINT_FCH_HALF_HYP_CFG3_ADDR A:0x43426d8
y.create.l HWIO_DINT_FCH_FULL_HYP_CFG0_ADDR A:0x43426dc
y.create.l HWIO_DINT_FCH_FULL_HYP_CFG1_ADDR A:0x43426e0
y.create.l HWIO_DINT_FCH_FULL_HYP_CFG2_ADDR A:0x43426e4
y.create.l HWIO_DINT_FCH_FULL_HYP_CFG3_ADDR A:0x43426e8
y.create.l HWIO_COMB_FUND_SOFT_DEC_IQ_WR_ADDR A:0x4342900
y.create.l HWIO_C_SYNC_TRIG_REG_ADDR A:0x4342904
y.create.l HWIO_CH0_Q_SOFTDEC_ENABLE_ADDR A:0x4342908
y.create.l HWIO_CH1_CONTROL_ADDR A:0x434290c
y.create.l HWIO_CH2_CONTROL_ADDR A:0x4342910
y.create.l HWIO_CDMA_WIDGET_STATUS0_ADDR A:0x4342914
y.create.l HWIO_RESET_STATUS0_ADDR A:0x4342918
y.create.l HWIO_CDMA_WIDGET_STATUS1_ADDR A:0x434291c
y.create.l HWIO_RESET_STATUS1_ADDR A:0x4342920
y.create.l HWIO_HDR_DINT_STATUS_ADDR A:0x4342c24
y.create.l HWIO_HDR_DINT_DBG_BUS_ADDR A:0x4342c80
y.create.l HWIO_HDR_DINT_CLK_STATUS_ADDR A:0x4342c84
y.create.l HWIO_DEMBACK_BUFF_MODE_ADDR A:0x4344004
y.create.l HWIO_DEMBACK_AHB_MEM_PAGE_ADDR A:0x4344008
y.create.l HWIO_DEMBACK_BUFF_MEM_CMD_ADDR A:0x4344010
y.create.l HWIO_DEMBACK_BUFF_MEM_WR_ADDR A:0x4344014
y.create.l HWIO_DEMBACK_BUFF_MEM_RD_ADDR A:0x4344018
y.create.l HWIO_DEMBACK_DBBUF_RDR0_CFG0_ADDR A:0x4344020
y.create.l HWIO_DEMBACK_DBBUF_RDR1_CFG0_ADDR A:0x434402c
y.create.l HWIO_DEMBACK_DBBUF_RDR2_CFG0_ADDR A:0x4344038
y.create.l HWIO_DEMBACK_DBBUF_RDR3_CFG0_ADDR A:0x4344044
y.create.l HWIO_DEMBACK_DBBUF_RDR0_CFG1_ADDR A:0x4344024
y.create.l HWIO_DEMBACK_DBBUF_RDR1_CFG1_ADDR A:0x4344030
y.create.l HWIO_DEMBACK_DBBUF_RDR2_CFG1_ADDR A:0x434403c
y.create.l HWIO_DEMBACK_DBBUF_RDR3_CFG1_ADDR A:0x4344048
y.create.l HWIO_DEMBACK_DBBUF_RDR0_XFER_CTL_ADDR A:0x4344028
y.create.l HWIO_DEMBACK_DBBUF_RDR1_XFER_CTL_ADDR A:0x4344034
y.create.l HWIO_DEMBACK_DBBUF_RDR2_XFER_CTL_ADDR A:0x4344040
y.create.l HWIO_DEMBACK_DBBUF_RDR3_XFER_CTL_ADDR A:0x434404c
y.create.l HWIO_DEMBACK_DBBUF_WRTR0_CFG0_ADDR A:0x4344080
y.create.l HWIO_DEMBACK_DBBUF_WRTR1_CFG0_ADDR A:0x434408c
y.create.l HWIO_DEMBACK_DBBUF_WRTR2_CFG0_ADDR A:0x4344098
y.create.l HWIO_DEMBACK_DBBUF_WRTR3_CFG0_ADDR A:0x43440a4
y.create.l HWIO_DEMBACK_DBBUF_WRTR0_CFG1_ADDR A:0x4344084
y.create.l HWIO_DEMBACK_DBBUF_WRTR1_CFG1_ADDR A:0x4344090
y.create.l HWIO_DEMBACK_DBBUF_WRTR2_CFG1_ADDR A:0x434409c
y.create.l HWIO_DEMBACK_DBBUF_WRTR3_CFG1_ADDR A:0x43440a8
y.create.l HWIO_DEMBACK_DBBUF_WRTR0_XFER_CTL_ADDR A:0x4344088
y.create.l HWIO_DEMBACK_DBBUF_WRTR1_XFER_CTL_ADDR A:0x4344094
y.create.l HWIO_DEMBACK_DBBUF_WRTR2_XFER_CTL_ADDR A:0x43440a0
y.create.l HWIO_DEMBACK_DBBUF_WRTR3_XFER_CTL_ADDR A:0x43440ac
y.create.l HWIO_DEMBACK_DBBUF_BRDG_CTL_ADDR A:0x4344100
y.create.l HWIO_DEMBACK_DBBUF_BRDG_STATUS_ADDR A:0x4344104
y.create.l HWIO_DEMBACK_DBBUF_BRDG_CLEAR_ADDR A:0x4344108
y.create.l HWIO_DEMBACK_BUFF_TBVD_DECOB_RD_MIN_ADDR A:0x4345000
y.create.l HWIO_DEMBACK_BUFF_TBVD_DECOB_RD_MAX_ADDR A:0x434577c
y.create.l HWIO_DEMBACK_BUFF_SVD_DECOB_RD_MIN_ADDR A:0x4346000
y.create.l HWIO_DEMBACK_BUFF_SVD_DECOB_RD_MAX_ADDR A:0x4346d7c
y.create.l HWIO_SVD_TBVD_CLK_STATUS_REG_ADDR A:0x4348000
y.create.l HWIO_SVD_TBVD_HW_IDLE_ADDR A:0x4348004
y.create.l HWIO_SVD_TBVD_TESTBUS_ENABLE_ADDR A:0x4348008
y.create.l HWIO_SVD_MODE_ADDR A:0x434800c
y.create.l HWIO_SVD_POLY2IJ_ADDR A:0x4348010
y.create.l HWIO_SVD_POLY3IJ_ADDR A:0x4348014
y.create.l HWIO_SVD_POLY3K_ADDR A:0x4348018
y.create.l HWIO_SVD_POLY4IJ_ADDR A:0x434801c
y.create.l HWIO_SVD_POLY4KL_ADDR A:0x4348020
y.create.l HWIO_SVD_TESTCON_ADDR A:0x4348024
y.create.l HWIO_SVD_TESTOUT_ADDR A:0x4348028
y.create.l HWIO_SVD_TEST_MEM_SEL_ADDR A:0x434802c
y.create.l HWIO_SVD_TEST_MEM_ADDR_ADDR A:0x4348030
y.create.l HWIO_SVD_TEST_MEM_WRITE_ADDR A:0x4348034
y.create.l HWIO_SVD_TEST_MEM_READ0_ADDR A:0x4348038
y.create.l HWIO_SVD_TEST_MEM_READ1_ADDR A:0x434803c
y.create.l HWIO_SVD_TEST_MEM_DIN_ADDR A:0x4348040
y.create.l HWIO_TBVD_DEBUG_MEM_CMD_ADDR A:0x4348044
y.create.l HWIO_TBVD_DEBUG_MEM_WR_ADDR A:0x4348048
y.create.l HWIO_TBVD_DEBUG_MEM_RD_ADDR A:0x434804c
y.create.l HWIO_LTE_DEMBACK_SCH_STATUS_WORD0_ADDR A:0x4349000
y.create.l HWIO_LTE_DEMBACK_SCH_SHARED_WORD0_ADDR A:0x4349100
y.create.l HWIO_LTE_DEMBACK_SCH_SHARED_WORD1_ADDR A:0x4349104
y.create.l HWIO_LTE_DEMBACK_SCH_SHARED_WORD2_ADDR A:0x4349108
y.create.l HWIO_LTE_DEMBACK_SCH_SHARED_WORD3_ADDR A:0x434910c
y.create.l HWIO_LTE_DEMBACK_SCH_SHARED_WORD4_ADDR A:0x4349110
y.create.l HWIO_LTE_DEMBACK_SCH_SHARED_WORD5_ADDR A:0x4349114
y.create.l HWIO_PDSCH_HARQ_CFG_WORD0_ADDR A:0x4349200
y.create.l HWIO_PDSCH_HARQ_CFG_WORD1_ADDR A:0x4349204
y.create.l HWIO_PDSCH_HARQ_CFG_WORD2_ADDR A:0x4349208
y.create.l HWIO_PDSCH_HARQ_CFG_WORD3_ADDR A:0x434920c
y.create.l HWIO_PDSCH_HARQ_CFG_WORD4_ADDR A:0x4349210
y.create.l HWIO_PDSCH_HARQ_CFG_WORD5_ADDR A:0x4349214
y.create.l HWIO_PDSCH_HARQ_CFG_WORD6_ADDR A:0x4349218
y.create.l HWIO_PDSCH_HARQ_CFG_WORD7_ADDR A:0x434921c
y.create.l HWIO_PDSCH_HARQ_CFG_WORD8_ADDR A:0x4349220
y.create.l HWIO_LTE_DEMBACK_CCH_STATUS_WORD0_ADDR A:0x434a000
y.create.l HWIO_LTE_DEMBACK_CCH_SHARED_WORD0_ADDR A:0x434a100
y.create.l HWIO_LTE_DEMBACK_CCH_SHARED_WORD1_ADDR A:0x434a104
y.create.l HWIO_LTE_DEMBACK_CCH_SHARED_WORD2_ADDR A:0x434a108
y.create.l HWIO_LTE_DEMBACK_CCH_SHARED_WORD3_ADDR A:0x434a10c
y.create.l HWIO_LTE_DEMBACK_CCH_SHARED_WORD4_ADDR A:0x434a110
y.create.l HWIO_LTE_DEMBACK_CCH_SHARED_WORD5_ADDR A:0x434a114
y.create.l HWIO_LTE_DEMBACK_CCH_SHARED_WORD6_ADDR A:0x434a118
y.create.l HWIO_LTE_DEMBACK_CCH_SHARED_WORD7_ADDR A:0x434a11c
y.create.l HWIO_PDCCH_DEINT_CFG_WORD0_ADDR A:0x434a200
y.create.l HWIO_PDCCH_DEINT_CFG_WORD1_ADDR A:0x434a204
y.create.l HWIO_PDCCH_DEINT_CFG_WORD2_ADDR A:0x434a208
y.create.l HWIO_SYMBOL0_REG_MAP_0_WORD0_ADDR A:0x434a300
y.create.l HWIO_SYMBOL0_REG_MAP_0_WORD1_ADDR A:0x434a304
y.create.l HWIO_SYMBOL0_REG_MAP_0_WORD2_ADDR A:0x434a308
y.create.l HWIO_SYMBOL0_REG_MAP_0_WORD3_ADDR A:0x434a30c
y.create.l HWIO_SYMBOL0_REG_MAP_0_WORD4_ADDR A:0x434a310
y.create.l HWIO_SYMBOL0_REG_MAP_0_WORD5_ADDR A:0x434a314
y.create.l HWIO_SYMBOL0_REG_MAP_0_WORD6_ADDR A:0x434a318
y.create.l HWIO_SYMBOL0_REG_MAP_0_WORD7_ADDR A:0x434a31c
y.create.l HWIO_SYMBOL0_REG_MAP_1_WORD0_ADDR A:0x434a400
y.create.l HWIO_SYMBOL0_REG_MAP_1_WORD1_ADDR A:0x434a404
y.create.l HWIO_SYMBOL0_REG_MAP_1_WORD2_ADDR A:0x434a408
y.create.l HWIO_SYMBOL0_REG_MAP_1_WORD3_ADDR A:0x434a40c
y.create.l HWIO_SYMBOL0_REG_MAP_1_WORD4_ADDR A:0x434a410
y.create.l HWIO_SYMBOL0_REG_MAP_1_WORD5_ADDR A:0x434a414
y.create.l HWIO_SYMBOL0_REG_MAP_1_WORD6_ADDR A:0x434a418
y.create.l HWIO_SYMBOL0_REG_MAP_1_WORD7_ADDR A:0x434a41c
y.create.l HWIO_SYMBOL0_REG_MAP_2_WORD0_ADDR A:0x434a500
y.create.l HWIO_SYMBOL0_REG_MAP_2_WORD1_ADDR A:0x434a504
y.create.l HWIO_SYMBOL0_REG_MAP_2_WORD2_ADDR A:0x434a508
y.create.l HWIO_SYMBOL0_REG_MAP_2_WORD3_ADDR A:0x434a50c
y.create.l HWIO_SYMBOL0_REG_MAP_2_WORD4_ADDR A:0x434a510
y.create.l HWIO_SYMBOL0_REG_MAP_2_WORD5_ADDR A:0x434a514
y.create.l HWIO_SYMBOL0_REG_MAP_2_WORD6_ADDR A:0x434a518
y.create.l HWIO_SYMBOL0_REG_MAP_2_WORD7_ADDR A:0x434a51c
y.create.l HWIO_SYMBOL1_REG_MAP_0_WORD0_ADDR A:0x434a600
y.create.l HWIO_SYMBOL1_REG_MAP_0_WORD1_ADDR A:0x434a604
y.create.l HWIO_SYMBOL1_REG_MAP_0_WORD2_ADDR A:0x434a608
y.create.l HWIO_SYMBOL1_REG_MAP_0_WORD3_ADDR A:0x434a60c
y.create.l HWIO_SYMBOL1_REG_MAP_0_WORD4_ADDR A:0x434a610
y.create.l HWIO_SYMBOL1_REG_MAP_0_WORD5_ADDR A:0x434a614
y.create.l HWIO_SYMBOL1_REG_MAP_0_WORD6_ADDR A:0x434a618
y.create.l HWIO_SYMBOL1_REG_MAP_0_WORD7_ADDR A:0x434a61c
y.create.l HWIO_SYMBOL1_REG_MAP_0_WORD8_ADDR A:0x434a620
y.create.l HWIO_SYMBOL1_REG_MAP_0_WORD9_ADDR A:0x434a624
y.create.l HWIO_SYMBOL1_REG_MAP_0_WORD10_ADDR A:0x434a628
y.create.l HWIO_SYMBOL1_REG_MAP_1_WORD0_ADDR A:0x434a700
y.create.l HWIO_SYMBOL1_REG_MAP_1_WORD1_ADDR A:0x434a704
y.create.l HWIO_SYMBOL1_REG_MAP_1_WORD2_ADDR A:0x434a708
y.create.l HWIO_SYMBOL1_REG_MAP_1_WORD3_ADDR A:0x434a70c
y.create.l HWIO_SYMBOL1_REG_MAP_1_WORD4_ADDR A:0x434a710
y.create.l HWIO_SYMBOL1_REG_MAP_1_WORD5_ADDR A:0x434a714
y.create.l HWIO_SYMBOL1_REG_MAP_1_WORD6_ADDR A:0x434a718
y.create.l HWIO_SYMBOL1_REG_MAP_1_WORD7_ADDR A:0x434a71c
y.create.l HWIO_SYMBOL1_REG_MAP_1_WORD8_ADDR A:0x434a720
y.create.l HWIO_SYMBOL1_REG_MAP_1_WORD9_ADDR A:0x434a724
y.create.l HWIO_SYMBOL1_REG_MAP_1_WORD10_ADDR A:0x434a728
y.create.l HWIO_SYMBOL2_REG_MAP_WORD0_ADDR A:0x434a800
y.create.l HWIO_SYMBOL2_REG_MAP_WORD1_ADDR A:0x434a804
y.create.l HWIO_SYMBOL2_REG_MAP_WORD2_ADDR A:0x434a808
y.create.l HWIO_SYMBOL2_REG_MAP_WORD3_ADDR A:0x434a80c
y.create.l HWIO_SYMBOL2_REG_MAP_WORD4_ADDR A:0x434a810
y.create.l HWIO_SYMBOL2_REG_MAP_WORD5_ADDR A:0x434a814
y.create.l HWIO_SYMBOL2_REG_MAP_WORD6_ADDR A:0x434a818
y.create.l HWIO_SYMBOL2_REG_MAP_WORD7_ADDR A:0x434a81c
y.create.l HWIO_SYMBOL2_REG_MAP_WORD8_ADDR A:0x434a820
y.create.l HWIO_SYMBOL2_REG_MAP_WORD9_ADDR A:0x434a824
y.create.l HWIO_SYMBOL2_REG_MAP_WORD10_ADDR A:0x434a828
y.create.l HWIO_PBCH_DEINT_CFG_WORD0_ADDR A:0x434a900
y.create.l HWIO_PBCH_DEINT_CFG_WORD1_ADDR A:0x434a904
y.create.l HWIO_PBCH_DEINT_CFG_WORD2_ADDR A:0x434a908
y.create.l HWIO_PBCH_DEINT_CFG_WORD3_ADDR A:0x434a90c
y.create.l HWIO_PBCH_DEINT_CFG_WORD4_ADDR A:0x434a910
y.create.l HWIO_PBCH_DEINT_CFG_WORD5_ADDR A:0x434a914
y.create.l HWIO_PBCH_DEINT_CFG_WORD6_ADDR A:0x434a918
y.create.l HWIO_PBCH_DEINT_CFG_WORD7_ADDR A:0x434a91c
y.create.l HWIO_PBCH_DEINT_CFG_WORD8_ADDR A:0x434a920
y.create.l HWIO_PBCH_DEINT_CFG_WORD9_ADDR A:0x434a924
y.create.l HWIO_PBCH_DEINT_CFG_WORD10_ADDR A:0x434a928
y.create.l HWIO_PDCCH_REG_REORDER_WORD0_ADDR A:0x434aa00
y.create.l HWIO_PDCCH_REG_REORDER_WORD1_ADDR A:0x434aa04
y.create.l HWIO_PDCCH_REG_REORDER_WORD2_ADDR A:0x434aa08
y.create.l HWIO_PDCCH_REG_REORDER_WORD3_ADDR A:0x434aa0c
y.create.l HWIO_PDCCH_REG_REORDER_WORD4_ADDR A:0x434aa10
y.create.l HWIO_PBCH_FOH_WORD0_ADDR A:0x434ab00
y.create.l HWIO_PBCH_FOH_WORD1_ADDR A:0x434ab04
y.create.l HWIO_PBCH_FOH_WORD2_ADDR A:0x434ab08
y.create.l HWIO_PDSCH_REENC_TB_CFG_WORD0_ADDR A:0x434b100
y.create.l HWIO_PDSCH_REENC_TB_CFG_WORD1_ADDR A:0x434b104
y.create.l HWIO_PDSCH_REENC_TB_CFG_WORD2_ADDR A:0x434b108
y.create.l HWIO_PDSCH_REENC_CB_WORD0_ADDR A:0x434b200
y.create.l HWIO_PDSCH_REENC_CB_WORD1_ADDR A:0x434b204
y.create.l HWIO_PDSCH_REENC_CB_WORD2_ADDR A:0x434b208
y.create.l HWIO_PBCH_REENC_WORD0_ADDR A:0x434b300
y.create.l HWIO_PBCH_REENC_WORD1_ADDR A:0x434b304
y.create.l HWIO_PBCH_REENC_WORD2_ADDR A:0x434b308
y.create.l HWIO_W_DBACK_HS_SHARED_WORD0_ADDR A:0x434c100
y.create.l HWIO_W_DBACK_HS_SHARED_WORD1_ADDR A:0x434c104
y.create.l HWIO_W_DBACK_HS_SHARED_WORD2_ADDR A:0x434c108
y.create.l HWIO_W_DBACK_HS_SHARED_WORD3_ADDR A:0x434c10c
y.create.l HWIO_W_DBACK_HS_SHARED_WORD4_ADDR A:0x434c110
y.create.l HWIO_W_DBACK_HS_SHARED_WORD5_ADDR A:0x434c114
y.create.l HWIO_W_DBACK_HS_SHARED_WORD6_ADDR A:0x434c118
y.create.l HWIO_W_DBACK_HS_SHARED_WORD7_ADDR A:0x434c11c
y.create.l HWIO_W_DBACK_HS_SHARED_WORD8_ADDR A:0x434c120
y.create.l HWIO_W_DBACK_HS_SHARED_WORD9_ADDR A:0x434c124
y.create.l HWIO_W_DBACK_HS_SHARED_WORD10_ADDR A:0x434c128
y.create.l HWIO_W_DBACK_HS_SHARED_WORD11_ADDR A:0x434c12c
y.create.l HWIO_W_DBACK_HS_SHARED_WORD12_ADDR A:0x434c130
y.create.l HWIO_W_DBACK_HS_SHARED_WORD13_ADDR A:0x434c134
y.create.l HWIO_W_DBACK_HS_SHARED_WORD14_ADDR A:0x434c138
y.create.l HWIO_W_DBACK_HS_SHARED_WORD15_ADDR A:0x434c13c
y.create.l HWIO_W_DBACK_HS_SHARED_WORD16_ADDR A:0x434c140
y.create.l HWIO_W_DBACK_HS_SHARED_WORD17_ADDR A:0x434c144
y.create.l HWIO_W_DBACK_HS_SHARED_WORD18_ADDR A:0x434c148
y.create.l HWIO_W_DBACK_HS_SHARED_WORD19_ADDR A:0x434c14c
y.create.l HWIO_W_DBACK_HS_SHARED_WORD20_ADDR A:0x434c150
y.create.l HWIO_W_DBACK_HS_SHARED_WORD21_ADDR A:0x434c154
y.create.l HWIO_W_DBACK_HS_SHARED_WORD22_ADDR A:0x434c158
y.create.l HWIO_W_DBACK_HS_SHARED_WORD23_ADDR A:0x434c15c
y.create.l HWIO_W_DBACK_HS_SHARED_WORD24_ADDR A:0x434c160
y.create.l HWIO_W_DBACK_HS_SHARED_WORD25_ADDR A:0x434c164
y.create.l HWIO_W_DBACK_HS_SHARED_WORD26_ADDR A:0x434c168
y.create.l HWIO_W_DBACK_HS_SHARED_WORD27_ADDR A:0x434c16c
y.create.l HWIO_W_DBACK_HS_SHARED_WORD28_ADDR A:0x434c170
y.create.l HWIO_W_DBACK_HS_SHARED_WORD29_ADDR A:0x434c174
y.create.l HWIO_W_DBACK_HS_SHARED_WORD30_ADDR A:0x434c178
y.create.l HWIO_W_DBACK_HS_SHARED_WORD31_ADDR A:0x434c17c
y.create.l HWIO_W_DBACK_HS_SHARED_WORD32_ADDR A:0x434c180
y.create.l HWIO_W_DBACK_HS_SHARED_WORD33_ADDR A:0x434c184
y.create.l HWIO_W_DBACK_HS_SHARED_WORD34_ADDR A:0x434c188
y.create.l HWIO_W_DBACK_HS_SHARED_WORD35_ADDR A:0x434c18c
y.create.l HWIO_W_DBACK_HS_SHARED_WORD36_ADDR A:0x434c190
y.create.l HWIO_W_DBACK_HS_SHARED_WORD37_ADDR A:0x434c194
y.create.l HWIO_W_DBACK_HS_SHARED_WORD38_ADDR A:0x434c198
y.create.l HWIO_W_DBACK_HS_SHARED_WORD39_ADDR A:0x434c19c
y.create.l HWIO_W_DBACK_HS_SHARED_WORD40_ADDR A:0x434c1a0
y.create.l HWIO_W_DBACK_HS_SHARED_WORD41_ADDR A:0x434c1a4
y.create.l HWIO_W_DBACK_HS_SHARED_WORD42_ADDR A:0x434c1a8
y.create.l HWIO_W_DBACK_HS_SHARED_WORD43_ADDR A:0x434c1ac
y.create.l HWIO_W_DBACK_HS_SHARED_WORD44_ADDR A:0x434c1b0
y.create.l HWIO_W_DBACK_HS_SHARED_WORD45_ADDR A:0x434c1b4
y.create.l HWIO_W_DBACK_HS_SHARED_WORD46_ADDR A:0x434c1b8
y.create.l HWIO_W_DBACK_HS_SHARED_WORD47_ADDR A:0x434c1bc
y.create.l HWIO_W_DBACK_HS_SHARED_WORD48_ADDR A:0x434c1c0
y.create.l HWIO_W_DBACK_HS_SHARED_WORD49_ADDR A:0x434c1c4
y.create.l HWIO_W_DBACK_HS_SHARED_WORD50_ADDR A:0x434c1c8
y.create.l HWIO_W_DBACK_HS_SHARED_WORD51_ADDR A:0x434c1cc
y.create.l HWIO_W_DBACK_HS_SHARED_WORD52_ADDR A:0x434c1d0
y.create.l HWIO_W_DBACK_HS_SHARED_WORD53_ADDR A:0x434c1d4
y.create.l HWIO_W_DBACK_HS_SHARED_WORD54_ADDR A:0x434c1d8
y.create.l HWIO_W_DBACK_HS_SHARED_WORD55_ADDR A:0x434c1dc
y.create.l HWIO_W_DBACK_HS_SHARED_WORD56_ADDR A:0x434c1e0
y.create.l HWIO_W_DBACK_HS_SHARED_WORD57_ADDR A:0x434c1e4
y.create.l HWIO_W_DBACK_HS_TD_DECIB_WRITER_WORD0_ADDR A:0x434c200
y.create.l HWIO_W_DBACK_HS_TD_DECIB_WRITER_CFG_WORD0_ADDR A:0x434c300
y.create.l HWIO_W_DBACK_HS_TD_DECIB_WRITER_CFG_WORD1_ADDR A:0x434c304
y.create.l HWIO_W_DBACK_HS_TD_DECIB_WRITER_CFG_WORD2_ADDR A:0x434c308
y.create.l HWIO_W_DBACK_HS_TD_DECIB_WRITER_CFG_WORD3_ADDR A:0x434c30c
y.create.l HWIO_W_DBACK_HS_TD_DECIB_WRITER_CFG_WORD4_ADDR A:0x434c310
y.create.l HWIO_W_DBACK_HS_TD_DECIB_WRITER_CFG_WORD5_ADDR A:0x434c314
y.create.l HWIO_W_DBACK_HS_TD_DECIB_WRITER_CFG_WORD6_ADDR A:0x434c318
y.create.l HWIO_W_DBACK_HS_TD_DECIB_WRITER_CFG_WORD7_ADDR A:0x434c31c
y.create.l HWIO_W_DBACK_NONHS_SHARED_WORD0_ADDR A:0x434d100
y.create.l HWIO_W_DBACK_NONHS_SHARED_WORD1_ADDR A:0x434d104
y.create.l HWIO_W_DBACK_NONHS_SHARED_WORD2_ADDR A:0x434d108
y.create.l HWIO_W_DBACK_NONHS_SHARED_WORD3_ADDR A:0x434d10c
y.create.l HWIO_W_DBACK_NONHS_SHARED_WORD4_ADDR A:0x434d110
y.create.l HWIO_W_DBACK_NONHS_SHARED_WORD5_ADDR A:0x434d114
y.create.l HWIO_W_DBACK_NONHS_SHARED_WORD6_ADDR A:0x434d118
y.create.l HWIO_W_DBACK_NONHS_SHARED_WORD7_ADDR A:0x434d11c
y.create.l HWIO_W_DBACK_NONHS_DRM_CFG_WORD0_ADDR A:0x434d200
y.create.l HWIO_W_DBACK_NONHS_DRM_CFG_WORD1_ADDR A:0x434d204
y.create.l HWIO_W_DBACK_NONHS_DRM_CFG_WORD2_ADDR A:0x434d208
y.create.l HWIO_W_DBACK_NONHS_DRM_CFG_WORD3_ADDR A:0x434d20c
y.create.l HWIO_W_DBACK_NONHS_DRM_CFG_WORD4_ADDR A:0x434d210
y.create.l HWIO_W_DBACK_NONHS_DRM_CFG_WORD5_ADDR A:0x434d214
y.create.l HWIO_W_DBACK_NONHS_DRM_CFG_WORD6_ADDR A:0x434d218
y.create.l HWIO_W_DBACK_NONHS_DRM_CFG_WORD7_ADDR A:0x434d21c
y.create.l HWIO_W_DBACK_NONHS_DRM_CFG_WORD8_ADDR A:0x434d220
y.create.l HWIO_W_DBACK_NONHS_DRM_CFG_WORD9_ADDR A:0x434d224
y.create.l HWIO_W_DBACK_NONHS_DRM_CFG_WORD10_ADDR A:0x434d228
y.create.l HWIO_W_DBACK_NONHS_DRM_CFG_WORD11_ADDR A:0x434d22c
y.create.l HWIO_W_DBACK_NONHS_DRM_CFG_WORD12_ADDR A:0x434d230
y.create.l HWIO_W_DBACK_NONHS_DRM_CFG_WORD13_ADDR A:0x434d234
y.create.l HWIO_W_DBACK_NONHS_DRM_CFG_WORD14_ADDR A:0x434d238
y.create.l HWIO_W_DBACK_NONHS_DRM_CFG_WORD15_ADDR A:0x434d23c
y.create.l HWIO_W_DBACK_NONHS_TD_DECIB_WRITER_CFG_WORD0_ADDR A:0x434d300
y.create.l HWIO_W_DBACK_NONHS_TD_DECIB_WRITER_CFG_WORD1_ADDR A:0x434d304
y.create.l HWIO_T_DBACK_SHARED_WORD0_ADDR A:0x434e100
y.create.l HWIO_T_DBACK_SHARED_WORD1_ADDR A:0x434e104
y.create.l HWIO_T_DBACK_SHARED_WORD2_ADDR A:0x434e108
y.create.l HWIO_T_DBACK_SHARED_WORD3_ADDR A:0x434e10c
y.create.l HWIO_T_DBACK_SHARED_WORD4_ADDR A:0x434e110
y.create.l HWIO_T_DBACK_SHARED_WORD5_ADDR A:0x434e114
y.create.l HWIO_T_DBACK_SHARED_WORD6_ADDR A:0x434e118
y.create.l HWIO_T_DBACK_SHARED_WORD7_ADDR A:0x434e11c
y.create.l HWIO_T_DBACK_SHARED_WORD8_ADDR A:0x434e120
y.create.l HWIO_T_DBACK_SHARED_WORD9_ADDR A:0x434e124
y.create.l HWIO_T_DBACK_SHARED_WORD10_ADDR A:0x434e128
y.create.l HWIO_T_DBACK_SHARED_WORD11_ADDR A:0x434e12c
y.create.l HWIO_T_DBACK_SHARED_WORD12_ADDR A:0x434e130
y.create.l HWIO_T_DBACK_SHARED_WORD13_ADDR A:0x434e134
y.create.l HWIO_T_DBACK_SHARED_WORD14_ADDR A:0x434e138
y.create.l HWIO_T_DBACK_SHARED_WORD15_ADDR A:0x434e13c
y.create.l HWIO_T_DBACK_SHARED_WORD16_ADDR A:0x434e140
y.create.l HWIO_T_DBACK_SHARED_WORD17_ADDR A:0x434e144
y.create.l HWIO_T_DBACK_SHARED_WORD18_ADDR A:0x434e148
y.create.l HWIO_T_DBACK_SHARED_WORD19_ADDR A:0x434e14c
y.create.l HWIO_T_DBACK_SHARED_WORD20_ADDR A:0x434e150
y.create.l HWIO_T_DBACK_SHARED_WORD21_ADDR A:0x434e154
y.create.l HWIO_T_DBACK_SHARED_WORD22_ADDR A:0x434e158
y.create.l HWIO_T_DBACK_SHARED_WORD23_ADDR A:0x434e15c
y.create.l HWIO_T_DBACK_SHARED_WORD24_ADDR A:0x434e160
y.create.l HWIO_T_DBACK_SHARED_WORD25_ADDR A:0x434e164
y.create.l HWIO_T_DBACK_SHARED_WORD26_ADDR A:0x434e168
y.create.l HWIO_T_DBACK_SHARED_WORD27_ADDR A:0x434e16c
y.create.l HWIO_T_DBACK_SHARED_WORD28_ADDR A:0x434e170
y.create.l HWIO_T_DBACK_SHARED_WORD29_ADDR A:0x434e174
y.create.l HWIO_T_DBACK_SHARED_WORD30_ADDR A:0x434e178
y.create.l HWIO_T_DBACK_SHARED_WORD31_ADDR A:0x434e17c
y.create.l HWIO_T_DBACK_SHARED_WORD32_ADDR A:0x434e180
y.create.l HWIO_T_DBACK_SHARED_WORD33_ADDR A:0x434e184
y.create.l HWIO_T_DBACK_SHARED_WORD34_ADDR A:0x434e188
y.create.l HWIO_T_DBACK_SHARED_WORD35_ADDR A:0x434e18c
y.create.l HWIO_T_DBACK_SHARED_WORD36_ADDR A:0x434e190
y.create.l HWIO_T_DBACK_SHARED_WORD37_ADDR A:0x434e194
y.create.l HWIO_T_DBACK_SHARED_WORD38_ADDR A:0x434e198
y.create.l HWIO_T_DBACK_NONHS_DRM_CFG_WORD0_ADDR A:0x434e200
y.create.l HWIO_T_DBACK_NONHS_DRM_CFG_WORD1_ADDR A:0x434e204
y.create.l HWIO_T_DBACK_NONHS_DRM_CFG_WORD2_ADDR A:0x434e208
y.create.l HWIO_T_DBACK_NONHS_DRM_CFG_WORD3_ADDR A:0x434e20c
y.create.l HWIO_T_DBACK_NONHS_DRM_CFG_WORD4_ADDR A:0x434e210
y.create.l HWIO_T_DBACK_NONHS_DRM_CFG_WORD5_ADDR A:0x434e214
y.create.l HWIO_T_DBACK_NONHS_DRM_CFG_WORD6_ADDR A:0x434e218
y.create.l HWIO_T_DBACK_NONHS_DRM_CFG_WORD7_ADDR A:0x434e21c
y.create.l HWIO_T_DBACK_NONHS_DRM_CFG_WORD8_ADDR A:0x434e220
y.create.l HWIO_T_DBACK_NONHS_DRM_CFG_WORD9_ADDR A:0x434e224
y.create.l HWIO_T_DBACK_NONHS_DRM_CFG_WORD10_ADDR A:0x434e228
y.create.l HWIO_T_DBACK_NONHS_DRM_CFG_WORD11_ADDR A:0x434e22c
y.create.l HWIO_T_DBACK_NONHS_DRM_CFG_WORD12_ADDR A:0x434e230
y.create.l HWIO_T_DBACK_NONHS_DRM_CFG_WORD13_ADDR A:0x434e234
y.create.l HWIO_T_DBACK_NONHS_DRM_CFG_WORD14_ADDR A:0x434e238
y.create.l HWIO_T_DBACK_NONHS_DRM_CFG_WORD15_ADDR A:0x434e23c
y.create.l HWIO_T_DBACK_NONHS_DRM_CFG_WORD16_ADDR A:0x434e240
y.create.l HWIO_T_DBACK_NONHS_DRM_CFG_WORD17_ADDR A:0x434e244
y.create.l HWIO_T_DBACK_NONHS_DRM_CFG_WORD18_ADDR A:0x434e248
y.create.l HWIO_T_DBACK_NONHS_DRM_CFG_WORD19_ADDR A:0x434e24c
y.create.l HWIO_T_DBACK_NONHS_DRM_CFG_WORD20_ADDR A:0x434e250
y.create.l HWIO_T_DBACK_NONHS_DRM_CFG_WORD21_ADDR A:0x434e254
y.create.l HWIO_T_DBACK_NONHS_DRM_CFG_WORD22_ADDR A:0x434e258
y.create.l HWIO_T_DBACK_NONHS_DRM_CFG_WORD23_ADDR A:0x434e25c
y.create.l HWIO_T_DBACK_NONHS_DRM_CFG_WORD24_ADDR A:0x434e260
y.create.l HWIO_T_DBACK_NONHS_DRM_CFG_WORD25_ADDR A:0x434e264
y.create.l HWIO_T_DBACK_NONHS_TD_DECIB_WRITER_CFG_WORD0_ADDR A:0x434e300
y.create.l HWIO_T_DBACK_NONHS_TD_DECIB_WRITER_CFG_WORD1_ADDR A:0x434e304
y.create.l HWIO_T_DBACK_HS_TD_DECIB_WRITER_CFG_WORD0_ADDR A:0x434e400
y.create.l HWIO_T_DBACK_HS_TD_DECIB_WRITER_CFG_WORD1_ADDR A:0x434e404
y.create.l HWIO_T_DBACK_HS_TD_DECIB_WRITER_CFG_WORD2_ADDR A:0x434e408
y.create.l HWIO_T_DBACK_HS_TD_DECIB_WRITER_CFG_WORD3_ADDR A:0x434e40c
y.create.l HWIO_T_DBACK_HS_TD_DECIB_WRITER_CFG_WORD4_ADDR A:0x434e410
y.create.l HWIO_T_DBACK_HS_TD_DECIB_WRITER_CFG_WORD5_ADDR A:0x434e414
y.create.l HWIO_T_DBACK_HS_TD_DECIB_WRITER_CFG_WORD6_ADDR A:0x434e418
y.create.l HWIO_T_DBACK_HS_TD_DECIB_WRITER_CFG_WORD7_ADDR A:0x434e41c
y.create.l HWIO_HDR_DEINT_CFG_WORD0_ADDR A:0x434f100
y.create.l HWIO_HDR_DEINT_CFG_WORD1_ADDR A:0x434f104
y.create.l HWIO_HDR_DEINT_CFG_WORD2_ADDR A:0x434f108
y.create.l HWIO_HDR_DEINT_CFG_WORD3_ADDR A:0x434f10c
y.create.l HWIO_HDR_DEINT_CFG_WORD4_ADDR A:0x434f110
y.create.l HWIO_HDR_DEINT_CFG_WORD5_ADDR A:0x434f114
y.create.l HWIO_HDR_DEINT_CFG_WORD6_ADDR A:0x434f118
y.create.l HWIO_HDR_DEINT_CFG_WORD7_ADDR A:0x434f11c
y.create.l HWIO_HDR_DEINT_CFG_WORD8_ADDR A:0x434f120
y.create.l HWIO_HDR_DEINT_CFG_WORD9_ADDR A:0x434f124
y.create.l HWIO_HDR_DEINT_CFG_WORD10_ADDR A:0x434f128
y.create.l HWIO_HDR_DEINT_CFG_WORD11_ADDR A:0x434f12c
y.create.l HWIO_HDR_DEINT_CFG_WORD12_ADDR A:0x434f130
y.create.l HWIO_HDR_DEINT_CFG_WORD13_ADDR A:0x434f134
y.create.l HWIO_HDR_DEINT_CFG_WORD14_ADDR A:0x434f138
y.create.l HWIO_HDR_DEINT_CFG_WORD15_ADDR A:0x434f13c
y.create.l HWIO_HDR_DEINT_CFG_WORD16_ADDR A:0x434f140
y.create.l HWIO_HDR_DEINT_WORD0_ADDR A:0x434f200
y.create.l HWIO_HDR_DEINT_WORD1_ADDR A:0x434f204
y.create.l HWIO_HDR_DEINT_WORD2_ADDR A:0x434f208
y.create.l HWIO_HDR_DEINT_WORD3_ADDR A:0x434f20c
y.create.l HWIO_HDR_DEINT_WORD4_ADDR A:0x434f210
y.create.l HWIO_HDR_DEINT_WORD5_ADDR A:0x434f214
y.create.l HWIO_HDR_DEINT_WORD6_ADDR A:0x434f218
y.create.l HWIO_HDR_DEINT_WORD7_ADDR A:0x434f21c
y.create.l HWIO_HDR_DEINT_WORD8_ADDR A:0x434f220
y.create.l HWIO_HDR_DEINT_WORD9_ADDR A:0x434f224
y.create.l HWIO_HDR_DEINT_WORD10_ADDR A:0x434f228
y.create.l HWIO_HDR_DEINT_WORD11_ADDR A:0x434f22c
y.create.l HWIO_HDR_DEINT_WORD12_ADDR A:0x434f230
y.create.l HWIO_HDR_DEINT_WORD13_ADDR A:0x434f234
y.create.l HWIO_TBVD_CCH_STATUS_WORD0_ADDR A:0x4350000
y.create.l HWIO_TBVD_CCH_LTE_CFG_WORD0_ADDR A:0x4350100
y.create.l HWIO_TBVD_CCH_LTE_CFG_WORD1_ADDR A:0x4350104
y.create.l HWIO_TBVD_CCH_LTE_CFG_WORD2_ADDR A:0x4350108
y.create.l HWIO_TBVD_CCH_LTE_CFG_WORD3_ADDR A:0x435010c
y.create.l HWIO_TBVD_CCH_LTE_CFG_WORD4_ADDR A:0x4350110
y.create.l HWIO_TBVD_CCH_LTE_CFG_WORD5_ADDR A:0x4350114
y.create.l HWIO_TBVD_CCH_LTE_CFG_WORD6_ADDR A:0x4350118
y.create.l HWIO_TBVD_CCH_LTE_CFG_WORD7_ADDR A:0x435011c
y.create.l HWIO_TBVD_CCH_LTE_CFG_WORD8_ADDR A:0x4350120
y.create.l HWIO_TBVD_CCH_LTE_CFG_WORD9_ADDR A:0x4350124
y.create.l HWIO_TBVD_CCH_LTE_CFG_WORD10_ADDR A:0x4350128
y.create.l HWIO_TBVD_CCH_LTE_CFG_WORD11_ADDR A:0x435012c
y.create.l HWIO_TBVD_CCH_LTE_CFG_WORD12_ADDR A:0x4350130
y.create.l HWIO_TBVD_CCH_LTE_CFG_WORD13_ADDR A:0x4350134
y.create.l HWIO_TBVD_CCH_LTE_CFG_WORD14_ADDR A:0x4350138
y.create.l HWIO_TBVD_CCH_LTE_CFG_WORD15_ADDR A:0x435013c
y.create.l HWIO_TBVD_CCH_LTE_CFG_WORD16_ADDR A:0x4350140
y.create.l HWIO_TBVD_CCH_LTE_CFG_WORD17_ADDR A:0x4350144
y.create.l HWIO_TBVD_CCH_LTE_CFG_WORD18_ADDR A:0x4350148
y.create.l HWIO_TBVD_CCH_LTE_CFG_WORD19_ADDR A:0x435014c
y.create.l HWIO_TBVD_CCH_LTE_PDCCH_WORD0_ADDR A:0x4350200
y.create.l HWIO_TBVD_CCH_LTE_PDCCH_WORD1_ADDR A:0x4350204
y.create.l HWIO_TBVD_CCH_LTE_PDCCH_WORD2_ADDR A:0x4350208
y.create.l HWIO_TBVD_CCH_LTE_PDCCH_WORD3_ADDR A:0x435020c
y.create.l HWIO_TBVD_CCH_LTE_PDCCH_WORD4_ADDR A:0x4350210
y.create.l HWIO_TBVD_CCH_LTE_PDCCH_WORD5_ADDR A:0x4350214
y.create.l HWIO_TBVD_CCH_LTE_PDCCH_WORD6_ADDR A:0x4350218
y.create.l HWIO_DEC_O_CCH_W_NONHS_LTE_PBCH_WORD0_ADDR A:0x4350300
y.create.l HWIO_DEC_O_CCH_W_NONHS_LTE_PBCH_WORD1_ADDR A:0x4350304
y.create.l HWIO_DEC_O_CCH_W_NONHS_LTE_PBCH_WORD2_ADDR A:0x4350308
y.create.l HWIO_DECOB_MEM_BASE_MIN_ADDR A:0x4350500
y.create.l HWIO_DECOB_MEM_BASE_MIN_INT_ADDR A:0x4358500
y.create.l HWIO_DECOB_MEM_BASE_MAX_ADDR A:0x435bdfc
y.create.l HWIO_HARQ_PAGE_START_ADDR A:0x435c000
y.create.l HWIO_HARQ_PAGE_END_ADDR A:0x435fffc
y.create.l HWIO_TDEC_CLK_CTL_ADDR A:0x433c000
y.create.l HWIO_TDEC_SW_CLK_EN_ADDR A:0x433c004
y.create.l HWIO_TDEC_CLK_STATUS_REG_ADDR A:0x433c008
y.create.l HWIO_TDEC_MODE_CTL_ADDR A:0x433c00c
y.create.l HWIO_TD_COMMON_CFG0_ADDR A:0x433c020
y.create.l HWIO_TD_COMMON_CFG1_ADDR A:0x433c024
y.create.l HWIO_TD_COMMON_CFG2_ADDR A:0x433c028
y.create.l HWIO_TD_COMMON_CFG3_ADDR A:0x433c02c
y.create.l HWIO_TD_COMMON_CFG4_ADDR A:0x433c030
y.create.l HWIO_TD_COMMON_CFG5_ADDR A:0x433c034
y.create.l HWIO_TD_COMMON_START_ADDR A:0x433c038
y.create.l HWIO_TD_1X_CFG_ADDR A:0x433c03c
y.create.l HWIO_TD_1X_DECOB_WRITE_PTR_ADDR A:0x433c040
y.create.l HWIO_TDEC_HW_IDLE_ADDR A:0x433c044
y.create.l HWIO_TDEC_PING_STATUS_0_ADDR A:0x433c048
y.create.l HWIO_TDEC_PING_STATUS_1_ADDR A:0x433c04c
y.create.l HWIO_TDEC_PONG_STATUS_0_ADDR A:0x433c050
y.create.l HWIO_TDEC_PONG_STATUS_1_ADDR A:0x433c054
y.create.l HWIO_TDEC_GERAN_STATUS_0_ADDR A:0x433c058
y.create.l HWIO_TDEC_GERAN_STATUS_1_ADDR A:0x433c05c
y.create.l HWIO_TDEC_TESTBUS_ENABLE_ADDR A:0x433c060
y.create.l HWIO_TDEC_TESTBUS_STATUS_ADDR A:0x433c064
y.create.l HWIO_DECIB_PAGE_ID_ADDR A:0x433c068
y.create.l HWIO_TDEC_AHB_ERROR_ADDR_RD_ADDR A:0x433c070
y.create.l HWIO_TEST_CRC_000_RD_ADDR A:0x433c074
y.create.l HWIO_TEST_CRC_001_RD_ADDR A:0x433c078
y.create.l HWIO_TEST_CRC_010_RD_ADDR A:0x433c07c
y.create.l HWIO_TEST_CRC_011_RD_ADDR A:0x433c080
y.create.l HWIO_TEST_CRC_100_RD_ADDR A:0x433c084
y.create.l HWIO_TEST_CRC_101_RD_ADDR A:0x433c088
y.create.l HWIO_TEST_CRC_110_RD_ADDR A:0x433c08c
y.create.l HWIO_TEST_CRC_111_RD_ADDR A:0x433c090
y.create.l HWIO_A2_TEST_SW_CFG_DATA0_ADDR A:0x433c094
y.create.l HWIO_A2_TEST_SW_CFG_DATA1_ADDR A:0x433c098
y.create.l HWIO_A2_TEST_SW_CFG_DATA2_ADDR A:0x433c09c
y.create.l HWIO_A2_TEST_SW_CFG_DATA3_ADDR A:0x433c0a0
y.create.l HWIO_A2_TEST_SW_CFG_DATA4_ADDR A:0x433c0a4
y.create.l HWIO_TD_CFG_STATUS_WORD0_ADDR A:0x433d000
y.create.l HWIO_LTE_CFG_WORD0_ADDR A:0x433d100
y.create.l HWIO_LTE_CFG_WORD1_ADDR A:0x433d104
y.create.l HWIO_LTE_CFG_WORD2_ADDR A:0x433d108
y.create.l HWIO_W_TD_CFG_WORD0_0_ADDR A:0x433d200
y.create.l HWIO_W_TD_CFG_WORD1_0_ADDR A:0x433d204
y.create.l HWIO_W_TD_CFG_WORD2_0_ADDR A:0x433d208
y.create.l HWIO_W_TD_CFG_WORD3_0_ADDR A:0x433d20c
y.create.l HWIO_W_TD_CFG_WORD4_0_ADDR A:0x433d210
y.create.l HWIO_W_TD_CFG_WORD5_0_ADDR A:0x433d214
y.create.l HWIO_W_TD_CFG_WORD6_0_ADDR A:0x433d218
y.create.l HWIO_W_TD_CFG_WORD7_0_ADDR A:0x433d21c
y.create.l HWIO_W_TD_CFG_WORD8_0_ADDR A:0x433d220
y.create.l HWIO_W_TD_CFG_WORD9_0_ADDR A:0x433d224
y.create.l HWIO_W_TD_CFG_WORD0_1_ADDR A:0x433d300
y.create.l HWIO_W_TD_CFG_WORD1_1_ADDR A:0x433d304
y.create.l HWIO_W_TD_CFG_WORD2_1_ADDR A:0x433d308
y.create.l HWIO_W_TD_CFG_WORD3_1_ADDR A:0x433d30c
y.create.l HWIO_W_TD_CFG_WORD4_1_ADDR A:0x433d310
y.create.l HWIO_W_TD_CFG_WORD5_1_ADDR A:0x433d314
y.create.l HWIO_W_TD_CFG_WORD6_1_ADDR A:0x433d318
y.create.l HWIO_W_TD_CFG_WORD7_1_ADDR A:0x433d31c
y.create.l HWIO_W_TD_CFG_WORD8_1_ADDR A:0x433d320
y.create.l HWIO_W_TD_CFG_WORD9_1_ADDR A:0x433d324
y.create.l HWIO_LTE_TRBLK_CFG_WORD0_0_ADDR A:0x433d400
y.create.l HWIO_LTE_TRBLK_CFG_WORD1_0_ADDR A:0x433d404
y.create.l HWIO_LTE_TRBLK_CFG_WORD2_0_ADDR A:0x433d408
y.create.l HWIO_LTE_TRBLK_CFG_WORD3_0_ADDR A:0x433d40c
y.create.l HWIO_LTE_TRBLK_CFG_WORD4_0_ADDR A:0x433d410
y.create.l HWIO_LTE_TRBLK_CFG_WORD5_0_ADDR A:0x433d414
y.create.l HWIO_LTE_TRBLK_CFG_WORD0_1_ADDR A:0x433d500
y.create.l HWIO_LTE_TRBLK_CFG_WORD1_1_ADDR A:0x433d504
y.create.l HWIO_LTE_TRBLK_CFG_WORD2_1_ADDR A:0x433d508
y.create.l HWIO_LTE_TRBLK_CFG_WORD3_1_ADDR A:0x433d50c
y.create.l HWIO_LTE_TRBLK_CFG_WORD4_1_ADDR A:0x433d510
y.create.l HWIO_LTE_TRBLK_CFG_WORD5_1_ADDR A:0x433d514
y.create.l HWIO_GERAN_TD_CFG_WORD0_0_ADDR A:0x433d600
y.create.l HWIO_GERAN_TD_CFG_WORD1_0_ADDR A:0x433d604
y.create.l HWIO_GERAN_TD_CFG_WORD2_0_ADDR A:0x433d608
y.create.l HWIO_GERAN_TD_CFG_WORD3_0_ADDR A:0x433d60c
y.create.l HWIO_GERAN_TD_CFG_WORD0_1_ADDR A:0x433d700
y.create.l HWIO_GERAN_TD_CFG_WORD1_1_ADDR A:0x433d704
y.create.l HWIO_GERAN_TD_CFG_WORD2_1_ADDR A:0x433d708
y.create.l HWIO_GERAN_TD_CFG_WORD3_1_ADDR A:0x433d70c
y.create.l HWIO_HDR_TD_CFG_WORD0_0_ADDR A:0x433d800
y.create.l HWIO_HDR_TD_CFG_WORD1_0_ADDR A:0x433d804
y.create.l HWIO_HDR_TD_CFG_WORD2_0_ADDR A:0x433d808
y.create.l HWIO_HDR_TD_CFG_WORD0_1_ADDR A:0x433d900
y.create.l HWIO_HDR_TD_CFG_WORD1_1_ADDR A:0x433d904
y.create.l HWIO_HDR_TD_CFG_WORD2_1_ADDR A:0x433d908
y.create.l HWIO_TD_STATUS_WORD0_ADDR A:0x433e000
y.create.l HWIO_W_TD_WORD0_0_ADDR A:0x433e100
y.create.l HWIO_W_TD_WORD0_1_ADDR A:0x433e200
y.create.l HWIO_LTE_PDSCH_WORD0_0_ADDR A:0x433e300
y.create.l HWIO_LTE_PDSCH_WORD1_0_ADDR A:0x433e304
y.create.l HWIO_LTE_PDSCH_WORD2_0_ADDR A:0x433e308
y.create.l HWIO_LTE_PDSCH_WORD0_1_ADDR A:0x433e400
y.create.l HWIO_LTE_PDSCH_WORD1_1_ADDR A:0x433e404
y.create.l HWIO_LTE_PDSCH_WORD2_1_ADDR A:0x433e408
y.create.l HWIO_GERAN_TD_WORD0_0_ADDR A:0x433e500
y.create.l HWIO_GERAN_TD_WORD1_0_ADDR A:0x433e504
y.create.l HWIO_GERAN_TD_WORD2_0_ADDR A:0x433e508
y.create.l HWIO_GERAN_TD_WORD3_0_ADDR A:0x433e50c
y.create.l HWIO_GERAN_TD_WORD4_0_ADDR A:0x433e510
y.create.l HWIO_GERAN_TD_WORD5_0_ADDR A:0x433e514
y.create.l HWIO_GERAN_TD_WORD6_0_ADDR A:0x433e518
y.create.l HWIO_GERAN_TD_WORD0_1_ADDR A:0x433e600
y.create.l HWIO_GERAN_TD_WORD1_1_ADDR A:0x433e604
y.create.l HWIO_GERAN_TD_WORD2_1_ADDR A:0x433e608
y.create.l HWIO_GERAN_TD_WORD3_1_ADDR A:0x433e60c
y.create.l HWIO_GERAN_TD_WORD4_1_ADDR A:0x433e610
y.create.l HWIO_GERAN_TD_WORD5_1_ADDR A:0x433e614
y.create.l HWIO_GERAN_TD_WORD6_1_ADDR A:0x433e618
y.create.l HWIO_HDR_TD_WORD0_0_ADDR A:0x433e700
y.create.l HWIO_HDR_TD_WORD1_0_ADDR A:0x433e704
y.create.l HWIO_HDR_TD_WORD2_0_ADDR A:0x433e708
y.create.l HWIO_HDR_TD_WORD3_0_ADDR A:0x433e70c
y.create.l HWIO_HDR_TD_WORD4_0_ADDR A:0x433e710
y.create.l HWIO_HDR_TD_WORD5_0_ADDR A:0x433e714
y.create.l HWIO_HDR_TD_WORD0_1_ADDR A:0x433e800
y.create.l HWIO_HDR_TD_WORD1_1_ADDR A:0x433e804
y.create.l HWIO_HDR_TD_WORD2_1_ADDR A:0x433e808
y.create.l HWIO_HDR_TD_WORD3_1_ADDR A:0x433e80c
y.create.l HWIO_HDR_TD_WORD4_1_ADDR A:0x433e810
y.create.l HWIO_HDR_TD_WORD5_1_ADDR A:0x433e814
y.create.l HWIO_TDECIB_MEM_START_ADDR A:0x433f000
y.create.l HWIO_TDECIB_MEM_END_ADDR A:0x433fffc
y.create.l HWIO_PDMEM_MIN_ADDR A:0x4300000
y.create.l HWIO_PDMEM_MAX_ADDR A:0x430fffc
y.create.l HWIO_CCS_MSTS_ADDR A:0x431fc00
y.create.l HWIO_CCS_MCTL_ADDR A:0x431fc04
y.create.l HWIO_CCS_IPC_ADDR A:0x431fc08
y.create.l HWIO_CCS_PIC0MSK_ADDR A:0x431fc0c
y.create.l HWIO_CCS_PIC0STS_ADDR A:0x431fc10
y.create.l HWIO_CCS_PIC1MSK_ADDR A:0x431fc14
y.create.l HWIO_CCS_PIC1STS_ADDR A:0x431fc18
y.create.l HWIO_CCS_PIC2MSK_ADDR A:0x431fc1c
y.create.l HWIO_CCS_PIC2STS_ADDR A:0x431fc20
y.create.l HWIO_CCS_PIC3MSK_ADDR A:0x431fc24
y.create.l HWIO_CCS_PIC3STS_ADDR A:0x431fc28
y.create.l HWIO_CCS_PIC4MSK_ADDR A:0x431fc2c
y.create.l HWIO_CCS_PIC4STS_ADDR A:0x431fc30
y.create.l HWIO_CCS_PIC5MSK_ADDR A:0x431fc34
y.create.l HWIO_CCS_PIC5STS_ADDR A:0x431fc38
y.create.l HWIO_CCS_PIC6MSK_ADDR A:0x431fc3c
y.create.l HWIO_CCS_PIC6STS_ADDR A:0x431fc40
y.create.l HWIO_CCS_PIT_ADDR A:0x431fc44
y.create.l HWIO_CCS_UTIME_ADDR A:0x431fc48
y.create.l HWIO_CCS_MON0_ADDR A:0x431fc4c
y.create.l HWIO_CCS_MON1_ADDR A:0x431fc50
y.create.l HWIO_CCS_MON2_ADDR A:0x431fc54
y.create.l HWIO_CCS_MON3_ADDR A:0x431fc58
y.create.l HWIO_CCS_MON4_ADDR A:0x431fc5c
y.create.l HWIO_CCS_MON5_ADDR A:0x431fc60
y.create.l HWIO_CCS_MON6_ADDR A:0x431fc64
y.create.l HWIO_CCS_MON7_ADDR A:0x431fc68
y.create.l HWIO_CCS_MON8_ADDR A:0x431fc6c
y.create.l HWIO_CCS_MON9_ADDR A:0x431fc70
y.create.l HWIO_CCS_TMR0_ADDR A:0x431fc7c
y.create.l HWIO_CCS_TMR1_ADDR A:0x431fc80
y.create.l HWIO_CCS_TMR2_ADDR A:0x431fc84
y.create.l HWIO_CCS_TMR3_ADDR A:0x431fc88
y.create.l HWIO_CCS_DMAC_ADDR A:0x431fc8c
y.create.l HWIO_CCS_DMAC0SRC_ADDR A:0x431fc90
y.create.l HWIO_CCS_DMAC1SRC_ADDR A:0x431fca0
y.create.l HWIO_CCS_DMAC2SRC_ADDR A:0x431fcb0
y.create.l HWIO_CCS_DMAC3SRC_ADDR A:0x431fcc0
y.create.l HWIO_CCS_DMAC4SRC_ADDR A:0x431fcd0
y.create.l HWIO_CCS_DMAC5SRC_ADDR A:0x431fce0
y.create.l HWIO_CCS_DMAC6SRC_ADDR A:0x431fcf0
y.create.l HWIO_CCS_DMAC7SRC_ADDR A:0x431fd00
y.create.l HWIO_CCS_DMAC0DST_ADDR A:0x431fc94
y.create.l HWIO_CCS_DMAC1DST_ADDR A:0x431fca4
y.create.l HWIO_CCS_DMAC2DST_ADDR A:0x431fcb4
y.create.l HWIO_CCS_DMAC3DST_ADDR A:0x431fcc4
y.create.l HWIO_CCS_DMAC4DST_ADDR A:0x431fcd4
y.create.l HWIO_CCS_DMAC5DST_ADDR A:0x431fce4
y.create.l HWIO_CCS_DMAC6DST_ADDR A:0x431fcf4
y.create.l HWIO_CCS_DMAC7DST_ADDR A:0x431fd04
y.create.l HWIO_CCS_DMAC0LNK_ADDR A:0x431fc98
y.create.l HWIO_CCS_DMAC1LNK_ADDR A:0x431fca8
y.create.l HWIO_CCS_DMAC2LNK_ADDR A:0x431fcb8
y.create.l HWIO_CCS_DMAC3LNK_ADDR A:0x431fcc8
y.create.l HWIO_CCS_DMAC4LNK_ADDR A:0x431fcd8
y.create.l HWIO_CCS_DMAC5LNK_ADDR A:0x431fce8
y.create.l HWIO_CCS_DMAC6LNK_ADDR A:0x431fcf8
y.create.l HWIO_CCS_DMAC7LNK_ADDR A:0x431fd08
y.create.l HWIO_CCS_DMAC0CTL_ADDR A:0x431fc9c
y.create.l HWIO_CCS_DMAC1CTL_ADDR A:0x431fcac
y.create.l HWIO_CCS_DMAC2CTL_ADDR A:0x431fcbc
y.create.l HWIO_CCS_DMAC3CTL_ADDR A:0x431fccc
y.create.l HWIO_CCS_DMAC4CTL_ADDR A:0x431fcdc
y.create.l HWIO_CCS_DMAC5CTL_ADDR A:0x431fcec
y.create.l HWIO_CCS_DMAC6CTL_ADDR A:0x431fcfc
y.create.l HWIO_CCS_DMAC7CTL_ADDR A:0x431fd0c
y.create.l HWIO_CCS_RFI_ADDR A:0x431fd10
y.create.l HWIO_CCS_SSBI0_ADDR A:0x431fd14
y.create.l HWIO_CCS_SSBI1_ADDR A:0x431fd1c
y.create.l HWIO_CCS_SSBI2_ADDR A:0x431fd24
y.create.l HWIO_CCS_SSBI3_ADDR A:0x431fd2c
y.create.l HWIO_CCS_SSBI0DAT_ADDR A:0x431fd18
y.create.l HWIO_CCS_SSBI1DAT_ADDR A:0x431fd20
y.create.l HWIO_CCS_SSBI2DAT_ADDR A:0x431fd28
y.create.l HWIO_CCS_SSBI3DAT_ADDR A:0x431fd30
y.create.l HWIO_CCS_GRFC_SET_ADDR A:0x431fd44
y.create.l HWIO_CCS_GRFC_CLR_ADDR A:0x431fd48
y.create.l HWIO_CCS_RFFE0_ADDR A:0x431fd4c
y.create.l HWIO_CCS_RFFE1_ADDR A:0x431fd64
y.create.l HWIO_CCS_RFFE2_ADDR A:0x431fd7c
y.create.l HWIO_CCS_RFFE3_ADDR A:0x431fd94
y.create.l HWIO_CCS_RFFE4_ADDR A:0x431fdac
y.create.l HWIO_CCS_RFFE0DAT0_ADDR A:0x431fd50
y.create.l HWIO_CCS_RFFE1DAT0_ADDR A:0x431fd68
y.create.l HWIO_CCS_RFFE2DAT0_ADDR A:0x431fd80
y.create.l HWIO_CCS_RFFE3DAT0_ADDR A:0x431fd98
y.create.l HWIO_CCS_RFFE4DAT0_ADDR A:0x431fdb0
y.create.l HWIO_CCS_RFFE0DAT1_ADDR A:0x431fd54
y.create.l HWIO_CCS_RFFE1DAT1_ADDR A:0x431fd6c
y.create.l HWIO_CCS_RFFE2DAT1_ADDR A:0x431fd84
y.create.l HWIO_CCS_RFFE3DAT1_ADDR A:0x431fd9c
y.create.l HWIO_CCS_RFFE4DAT1_ADDR A:0x431fdb4
y.create.l HWIO_CCS_RFFE0DAT2_ADDR A:0x431fd58
y.create.l HWIO_CCS_RFFE1DAT2_ADDR A:0x431fd70
y.create.l HWIO_CCS_RFFE2DAT2_ADDR A:0x431fd88
y.create.l HWIO_CCS_RFFE3DAT2_ADDR A:0x431fda0
y.create.l HWIO_CCS_RFFE4DAT2_ADDR A:0x431fdb8
y.create.l HWIO_CCS_RFFE0DAT3_ADDR A:0x431fd5c
y.create.l HWIO_CCS_RFFE1DAT3_ADDR A:0x431fd74
y.create.l HWIO_CCS_RFFE2DAT3_ADDR A:0x431fd8c
y.create.l HWIO_CCS_RFFE3DAT3_ADDR A:0x431fda4
y.create.l HWIO_CCS_RFFE4DAT3_ADDR A:0x431fdbc
y.create.l HWIO_CCS_RFFE0_STS_ADDR A:0x431fd60
y.create.l HWIO_CCS_RFFE1_STS_ADDR A:0x431fd78
y.create.l HWIO_CCS_RFFE2_STS_ADDR A:0x431fd90
y.create.l HWIO_CCS_RFFE3_STS_ADDR A:0x431fda8
y.create.l HWIO_CCS_RFFE4_STS_ADDR A:0x431fdc0
y.create.l HWIO_CCS_BP0_ADDR A:0x431fe3c
y.create.l HWIO_CCS_BP1_ADDR A:0x431fe40
y.create.l HWIO_MTC_ENABLE_ADDR A:0x4320000
y.create.l HWIO_MODEM_PWRUP_ADDR A:0x4320004
y.create.l HWIO_MODEM_PWRON_ADDR A:0x4320008
y.create.l HWIO_MODEM_ID_ADDR A:0x432000c
y.create.l HWIO_MODEM_FEATURE_EN_ADDR A:0x4320010
y.create.l HWIO_MODEM_OPTION_EN_ADDR A:0x4320014
y.create.l HWIO_MODEM_CLK_AXI_CFG_ADDR A:0x4320018
y.create.l HWIO_MODEM_CLK_AXI_TRIG_ADDR A:0x432001c
y.create.l HWIO_MODEM_CLK_AXI_STATUS_ADDR A:0x4320020
y.create.l HWIO_MODEM_CLK_TDEC_CFG_ADDR A:0x4320024
y.create.l HWIO_MODEM_CLK_TDEC_TRIG_ADDR A:0x4320028
y.create.l HWIO_MODEM_CLK_TDEC_STATUS_ADDR A:0x432002c
y.create.l HWIO_MODEM_CLK_DBG_CFG_ADDR A:0x4320030
y.create.l HWIO_MODEM_CLK_SPARE_ADDR A:0x4320034
y.create.l HWIO_MCDMA_RESET_ADDR A:0x4320400
y.create.l HWIO_MCDMA_ENABLE_ADDR A:0x432049c
y.create.l HWIO_MCDMA_LOG_CH_BUSY_ADDR A:0x4320404
y.create.l HWIO_MCDMA_LOG_HW_CH0_SYNC_ADDR A:0x4320408
y.create.l HWIO_MCDMA_LOG_HW_CH1_SYNC_ADDR A:0x432040c
y.create.l HWIO_MCDMA_LOG_HW_CH2_SYNC_ADDR A:0x4320410
y.create.l HWIO_MCDMA_LOG_HW_CH3_SYNC_ADDR A:0x4320414
y.create.l HWIO_MCDMA_LOG_HW_CH4_SYNC_ADDR A:0x4320418
y.create.l HWIO_MCDMA_LOG_HW_CH0_CTL_ADDR A:0x4320420
y.create.l HWIO_MCDMA_LOG_HW_CH1_CTL_ADDR A:0x4320424
y.create.l HWIO_MCDMA_LOG_HW_CH2_CTL_ADDR A:0x4320428
y.create.l HWIO_MCDMA_LOG_HW_CH3_CTL_ADDR A:0x432042c
y.create.l HWIO_MCDMA_LOG_HW_CH4_CTL_ADDR A:0x4320430
y.create.l HWIO_MCDMA_LOG_SW_CH0_RESET_ADDR A:0x4320438
y.create.l HWIO_MCDMA_LOG_SW_CH1_RESET_ADDR A:0x432043c
y.create.l HWIO_MCDMA_LOG_SW_CH2_RESET_ADDR A:0x4320440
y.create.l HWIO_MCDMA_LOG_SW_CH3_RESET_ADDR A:0x4320444
y.create.l HWIO_MCDMA_LOG_SW_CH0_CTL_ADDR A:0x432044c
y.create.l HWIO_MCDMA_LOG_SW_CH1_CTL_ADDR A:0x4320450
y.create.l HWIO_MCDMA_LOG_SW_CH2_CTL_ADDR A:0x4320454
y.create.l HWIO_MCDMA_LOG_SW_CH3_CTL_ADDR A:0x4320458
y.create.l HWIO_MCDMA_PHY_CH_CTL_ADDR A:0x4320460
y.create.l HWIO_MCDMA_LOG_HW_CH0_DBG_ADDR A:0x4320464
y.create.l HWIO_MCDMA_LOG_HW_CH1_DBG_ADDR A:0x4320468
y.create.l HWIO_MCDMA_LOG_HW_CH2_DBG_ADDR A:0x432046c
y.create.l HWIO_MCDMA_LOG_HW_CH3_DBG_ADDR A:0x4320470
y.create.l HWIO_MCDMA_LOG_HW_CH4_DBG_ADDR A:0x4320474
y.create.l HWIO_MCDMA_LOG_SW_CH0_DBG_ADDR A:0x4320478
y.create.l HWIO_MCDMA_LOG_SW_CH1_DBG_ADDR A:0x432047c
y.create.l HWIO_MCDMA_LOG_SW_CH2_DBG_ADDR A:0x4320480
y.create.l HWIO_MCDMA_LOG_SW_CH3_DBG_ADDR A:0x4320484
y.create.l HWIO_MCDMA_PHY_CH_DBG_ADDR A:0x4320488
y.create.l HWIO_MCDMA_VBUF_CFG_DBG_ADDR A:0x432048c
y.create.l HWIO_MCDMA_VBUF_CFG_SEL_ADDR A:0x4320490
y.create.l HWIO_MCDMA_VBUF_CFG_RD0_ADDR A:0x4320494
y.create.l HWIO_MCDMA_VBUF_CFG_RD1_ADDR A:0x4320498
y.create.l HWIO_A2_SW_RESET_THRD_ADDR A:0x4320800
y.create.l HWIO_A2_SW_RESET_ACC_ADDR A:0x4320804
y.create.l HWIO_A2_TASK0_EN_ADDR A:0x4320808
y.create.l HWIO_A2_TASK1_EN_ADDR A:0x432080c
y.create.l HWIO_A2_TASK2_EN_ADDR A:0x4320810
y.create.l HWIO_A2_TASK3_EN_ADDR A:0x4320814
y.create.l HWIO_A2_TASK0_WR_PTR_ADDR A:0x4320820
y.create.l HWIO_A2_TASK1_WR_PTR_ADDR A:0x4320824
y.create.l HWIO_A2_TASK2_WR_PTR_ADDR A:0x4320828
y.create.l HWIO_A2_TASK3_WR_PTR_ADDR A:0x432082c
y.create.l HWIO_A2_TASK0_RD_PTR_ADDR A:0x4320840
y.create.l HWIO_A2_TASK1_RD_PTR_ADDR A:0x4320844
y.create.l HWIO_A2_TASK2_RD_PTR_ADDR A:0x4320848
y.create.l HWIO_A2_TASK3_RD_PTR_ADDR A:0x432084c
y.create.l HWIO_A2_TASK0_RD_PTR_INIT_ADDR A:0x4320860
y.create.l HWIO_A2_TASK1_RD_PTR_INIT_ADDR A:0x4320864
y.create.l HWIO_A2_TASK2_RD_PTR_INIT_ADDR A:0x4320868
y.create.l HWIO_A2_TASK3_RD_PTR_INIT_ADDR A:0x432086c
y.create.l HWIO_A2_TASK0_RD_PTR_INIT_EN_ADDR A:0x4320880
y.create.l HWIO_A2_TASK1_RD_PTR_INIT_EN_ADDR A:0x4320884
y.create.l HWIO_A2_TASK2_RD_PTR_INIT_EN_ADDR A:0x4320888
y.create.l HWIO_A2_TASK3_RD_PTR_INIT_EN_ADDR A:0x432088c
y.create.l HWIO_A2_QUEUE_UPPER_ADDR_ADDR A:0x43208b0
y.create.l HWIO_A2_STATUS0_WR_EN_ADDR A:0x43208c8
y.create.l HWIO_A2_STATUS1_WR_EN_ADDR A:0x43208cc
y.create.l HWIO_A2_STATUS2_WR_EN_ADDR A:0x43208d0
y.create.l HWIO_A2_STATUS3_WR_EN_ADDR A:0x43208d4
y.create.l HWIO_A2_STATUS4_WR_EN_ADDR A:0x43208d8
y.create.l HWIO_A2_STATUS0_WR_START_ADDR A:0x43208dc
y.create.l HWIO_A2_STATUS1_WR_START_ADDR A:0x43208e0
y.create.l HWIO_A2_STATUS2_WR_START_ADDR A:0x43208e4
y.create.l HWIO_A2_STATUS3_WR_START_ADDR A:0x43208e8
y.create.l HWIO_A2_STATUS4_WR_START_ADDR A:0x43208ec
y.create.l HWIO_A2_STATUS0_WR_END_ADDR A:0x43208f0
y.create.l HWIO_A2_STATUS1_WR_END_ADDR A:0x43208f4
y.create.l HWIO_A2_STATUS2_WR_END_ADDR A:0x43208f8
y.create.l HWIO_A2_STATUS3_WR_END_ADDR A:0x43208fc
y.create.l HWIO_A2_STATUS4_WR_END_ADDR A:0x4320900
y.create.l HWIO_A2_STATUS0_WR_PTR_INIT_ADDR A:0x4320904
y.create.l HWIO_A2_STATUS1_WR_PTR_INIT_ADDR A:0x4320908
y.create.l HWIO_A2_STATUS2_WR_PTR_INIT_ADDR A:0x432090c
y.create.l HWIO_A2_STATUS3_WR_PTR_INIT_ADDR A:0x4320910
y.create.l HWIO_A2_STATUS4_WR_PTR_INIT_ADDR A:0x4320914
y.create.l HWIO_A2_STATUS0_WR_PTR_INIT_EN_ADDR A:0x4320918
y.create.l HWIO_A2_STATUS1_WR_PTR_INIT_EN_ADDR A:0x432091c
y.create.l HWIO_A2_STATUS2_WR_PTR_INIT_EN_ADDR A:0x4320920
y.create.l HWIO_A2_STATUS3_WR_PTR_INIT_EN_ADDR A:0x4320924
y.create.l HWIO_A2_STATUS4_WR_PTR_INIT_EN_ADDR A:0x4320928
y.create.l HWIO_A2_STATUS0_WR_PTR_CURRENT_ADDR A:0x432092c
y.create.l HWIO_A2_STATUS1_WR_PTR_CURRENT_ADDR A:0x4320930
y.create.l HWIO_A2_STATUS2_WR_PTR_CURRENT_ADDR A:0x4320934
y.create.l HWIO_A2_STATUS3_WR_PTR_CURRENT_ADDR A:0x4320938
y.create.l HWIO_A2_STATUS4_WR_PTR_CURRENT_ADDR A:0x432093c
y.create.l HWIO_A2_STATUS0_WR_PTR_ADDR A:0x4320940
y.create.l HWIO_A2_STATUS1_WR_PTR_ADDR A:0x4320944
y.create.l HWIO_A2_STATUS2_WR_PTR_ADDR A:0x4320948
y.create.l HWIO_A2_STATUS3_WR_PTR_ADDR A:0x432094c
y.create.l HWIO_A2_STATUS4_WR_PTR_ADDR A:0x4320950
y.create.l HWIO_A2_STATUS0_RD_PTR_ADDR A:0x4320954
y.create.l HWIO_A2_STATUS1_RD_PTR_ADDR A:0x4320958
y.create.l HWIO_A2_STATUS2_RD_PTR_ADDR A:0x432095c
y.create.l HWIO_A2_STATUS3_RD_PTR_ADDR A:0x4320960
y.create.l HWIO_A2_STATUS4_RD_PTR_ADDR A:0x4320964
y.create.l HWIO_A2_FRAG0_THRESHOLD_ADDR A:0x43209c0
y.create.l HWIO_A2_FRAG1_THRESHOLD_ADDR A:0x43209c4
y.create.l HWIO_A2_FRAG0_REFILL_EN_ADDR A:0x43209c8
y.create.l HWIO_A2_FRAG1_REFILL_EN_ADDR A:0x43209cc
y.create.l HWIO_A2_FRAG0_LEN_ADDR A:0x43209d0
y.create.l HWIO_A2_FRAG1_LEN_ADDR A:0x43209d4
y.create.l HWIO_A2_FRAG0_ADDR_ADDR A:0x43209d8
y.create.l HWIO_A2_FRAG1_ADDR_ADDR A:0x43209dc
y.create.l HWIO_A2_FRAG0_PTR_ADDR A:0x43209e0
y.create.l HWIO_A2_FRAG1_PTR_ADDR A:0x43209e4
y.create.l HWIO_A2_FRAG_CACHE_LINE_ADDR A:0x43209e8
y.create.l HWIO_A2_FRAG_CACHE_LINE_MASK_ADDR A:0x43209ec
y.create.l HWIO_A2_FRAG0_TRANSFER_LEN_ADDR A:0x43209f0
y.create.l HWIO_A2_FRAG1_TRANSFER_LEN_ADDR A:0x43209f4
y.create.l HWIO_A2_FRAG0_HDR_LEN_ADDR A:0x43209f8
y.create.l HWIO_A2_FRAG1_HDR_LEN_ADDR A:0x43209fc
y.create.l HWIO_A2_FRAG0_QUEUE_START_ADDR_ADDR A:0x4320a08
y.create.l HWIO_A2_FRAG1_QUEUE_START_ADDR_ADDR A:0x4320a0c
y.create.l HWIO_A2_FRAG0_QUEUE_WR_PTR_ADDR A:0x4320aa0
y.create.l HWIO_A2_FRAG1_QUEUE_WR_PTR_ADDR A:0x4320aa4
y.create.l HWIO_A2_FRAG0_QUEUE_RD_PTR_ADDR A:0x4320aa8
y.create.l HWIO_A2_FRAG1_QUEUE_RD_PTR_ADDR A:0x4320aac
y.create.l HWIO_A2_FRAG0_RD_PTR_INIT_EN_ADDR A:0x4320acc
y.create.l HWIO_A2_FRAG1_RD_PTR_INIT_EN_ADDR A:0x4320ad0
y.create.l HWIO_A2_TIMER0_CFG_ADDR A:0x4320a10
y.create.l HWIO_A2_TIMER1_CFG_ADDR A:0x4320a14
y.create.l HWIO_A2_TIMER2_CFG_ADDR A:0x4320a18
y.create.l HWIO_A2_TIMER3_CFG_ADDR A:0x4320a1c
y.create.l HWIO_A2_TIMER0_CMD_ADDR A:0x4320a20
y.create.l HWIO_A2_TIMER1_CMD_ADDR A:0x4320a24
y.create.l HWIO_A2_TIMER2_CMD_ADDR A:0x4320a28
y.create.l HWIO_A2_TIMER3_CMD_ADDR A:0x4320a2c
y.create.l HWIO_A2_TIMER0_PERIOD_ADDR A:0x4320a40
y.create.l HWIO_A2_TIMER1_PERIOD_ADDR A:0x4320a44
y.create.l HWIO_A2_TIMER2_PERIOD_ADDR A:0x4320a48
y.create.l HWIO_A2_TIMER3_PERIOD_ADDR A:0x4320a4c
y.create.l HWIO_A2_TIMER0_STATUS_ADDR A:0x4320a50
y.create.l HWIO_A2_TIMER1_STATUS_ADDR A:0x4320a54
y.create.l HWIO_A2_TIMER2_STATUS_ADDR A:0x4320a58
y.create.l HWIO_A2_TIMER3_STATUS_ADDR A:0x4320a5c
y.create.l HWIO_A2_PER_DL_CFG_ADDR A:0x4320a70
y.create.l HWIO_A2_PER0_UL_CFG_ADDR A:0x4320a74
y.create.l HWIO_A2_PER1_UL_CFG_ADDR A:0x4320a78
y.create.l HWIO_A2_PER2_UL_CFG_ADDR A:0x4320a7c
y.create.l HWIO_A2_CKSUM_CFG_ADDR A:0x4320adc
y.create.l HWIO_A2_DL_PHY_DEC_TRBLK_THRESHOLD_ADDR A:0x4320a90
y.create.l HWIO_A2_DL_PHY_CFG_ADDR A:0x4320a94
y.create.l HWIO_A2_HW_THRD_EN_ADDR A:0x4320a98
y.create.l HWIO_A2_UL_PHY_CFG_ADDR A:0x4320a9c
y.create.l HWIO_A2_LTE_DLPHY_CMD_ADDR_ADDR A:0x4320ab0
y.create.l HWIO_A2_IP_FILT_FRAG_ADDR_ADDR A:0x4320ab4
y.create.l HWIO_A2_MCDMA_DMA_IN_ADDR_ADDR A:0x4320ab8
y.create.l HWIO_A2_MCDMA_DMA_OUT_ADDR_ADDR A:0x4320abc
y.create.l HWIO_A2_MCDMA_TASK_ADDR_ADDR A:0x4320ac0
y.create.l HWIO_A2_MCDMA_BAM_NDP_ADDR_ADDR A:0x4320ac4
y.create.l HWIO_A2_DECOB_PREFETCH_ADDR_ADDR A:0x4320ac8
y.create.l HWIO_A2_MCDMA_OST_BRST_ADDR A:0x4320ad4
y.create.l HWIO_A2_MCDMA_MAX_BRST_SIZE_ADDR A:0x4320ad8
y.create.l HWIO_A2_HW_CLK_CTL_ADDR A:0x4320ae0
y.create.l HWIO_A2_CLK_EN_CTL_ADDR A:0x4320ae4
y.create.l HWIO_A2_CLK_STATUS_ADDR A:0x4320ae8
y.create.l HWIO_A2_UL_PER_1ST_PKT_INT_EN_ADDR A:0x4320aec
y.create.l HWIO_A2_DBG_LINK_RD_ADDR A:0x4320af0
y.create.l HWIO_A2_DBG_LINK1_RD_ADDR A:0x4320af4
y.create.l HWIO_A2_DBG_FRAG0_LEN_ADDR A:0x4320af8
y.create.l HWIO_A2_DBG_FRAG1_LEN_ADDR A:0x4320afc
y.create.l HWIO_A2_DBG_FRAG2_LEN_ADDR A:0x4320b00
y.create.l HWIO_A2_DBG_FRAG3_LEN_ADDR A:0x4320b04
y.create.l HWIO_A2_DBG_FRAG4_LEN_ADDR A:0x4320b08
y.create.l HWIO_A2_DBG_FRAG0_ADDR_CUR_ADDR A:0x4320b0c
y.create.l HWIO_A2_DBG_FRAG1_ADDR_CUR_ADDR A:0x4320b10
y.create.l HWIO_A2_DBG_FRAG2_ADDR_CUR_ADDR A:0x4320b14
y.create.l HWIO_A2_DBG_FRAG3_ADDR_CUR_ADDR A:0x4320b18
y.create.l HWIO_A2_DBG_FRAG4_ADDR_CUR_ADDR A:0x4320b1c
y.create.l HWIO_A2_DBG_FRAG0_ADDR_NXT_ADDR A:0x4320b20
y.create.l HWIO_A2_DBG_FRAG1_ADDR_NXT_ADDR A:0x4320b24
y.create.l HWIO_A2_DBG_FRAG2_ADDR_NXT_ADDR A:0x4320b28
y.create.l HWIO_A2_DBG_FRAG3_ADDR_NXT_ADDR A:0x4320b2c
y.create.l HWIO_A2_DBG_FRAG4_ADDR_NXT_ADDR A:0x4320b30
y.create.l HWIO_A2_DBG_FRAG0_PTR_ADDR A:0x4320b34
y.create.l HWIO_A2_DBG_FRAG1_PTR_ADDR A:0x4320b38
y.create.l HWIO_A2_DBG_FRAG2_PTR_ADDR A:0x4320b3c
y.create.l HWIO_A2_DBG_FRAG3_PTR_ADDR A:0x4320b40
y.create.l HWIO_A2_DBG_FRAG4_PTR_ADDR A:0x4320b44
y.create.l HWIO_A2_DBG_TRBLK_LENGTH_ADDR A:0x4320b60
y.create.l HWIO_A2_DBG_TRBLK_START_ADDR_ADDR A:0x4320b64
y.create.l HWIO_A2_DBG_TRBLK_SW_INFO0_ADDR A:0x4320b68
y.create.l HWIO_A2_DBG_TRBLK_SW_INFO1_ADDR A:0x4320b6c
y.create.l HWIO_A2_DBG_TRBLK_TRIGGER_ADDR A:0x4320b70
y.create.l HWIO_A2_DBG_TRBLK_STATUS_ADDR A:0x4320b74
y.create.l HWIO_A2_DBG_STRM_ID_ADDR A:0x4320b80
y.create.l HWIO_A2_DBG_DMA_SRC_ADDR A:0x4320b84
y.create.l HWIO_A2_DBG_DMA_DST_ADDR A:0x4320b8c
y.create.l HWIO_A2_DBG_DMA_CTL_ADDR A:0x4320b90
y.create.l HWIO_A2_DBG_TASK_FETCHER_ADDR A:0x4320b94
y.create.l HWIO_A2_DBG_DL0_BAM_ADDR A:0x4320b98
y.create.l HWIO_A2_DBG_DL1_BAM_ADDR A:0x4320b9c
y.create.l HWIO_A2_DBG_DL2_BAM_ADDR A:0x4320ba0
y.create.l HWIO_A2_DBG_UL0_BAM_ADDR A:0x4320ba4
y.create.l HWIO_A2_DBG_UL1_BAM_ADDR A:0x4320ba8
y.create.l HWIO_A2_DBG_UL2_BAM_ADDR A:0x4320bac
y.create.l HWIO_A2_DBG_FRM_ADDR A:0x4320bb0
y.create.l HWIO_A2_DBG_DFRM_ADDR A:0x4320bb4
y.create.l HWIO_A2_DBG_CIPH_ADDR A:0x4320bb8
y.create.l HWIO_A2_DBG_IPF_ADDR A:0x4320bbc
y.create.l HWIO_A2_DBG_MIU0_ADDR A:0x4320bc0
y.create.l HWIO_A2_DBG_MIU1_ADDR A:0x4320bc4
y.create.l HWIO_A2_DBG_MIU2_ADDR A:0x4320bc8
y.create.l HWIO_A2_DBG_MIU3_ADDR A:0x4320bcc
y.create.l HWIO_A2_DBG_TASK_WORD_ADDR A:0x4320bd0
y.create.l HWIO_A2_DBG_UL_CKSUM0_ADDR A:0x4320bd4
y.create.l HWIO_A2_DBG_UL_CKSUM1_ADDR A:0x4320bd8
y.create.l HWIO_A2_DBG_DL_CKSUM0_ADDR A:0x4320bdc
y.create.l HWIO_A2_DBG_DL_CKSUM1_ADDR A:0x4320be0
y.create.l HWIO_A2_DBG_CKSUM_UL_EOT_ADDR A:0x4320be4
y.create.l HWIO_DBG_RESET_ADDR A:0x4320c00
y.create.l HWIO_DBG_ENABLE_ADDR A:0x4320c04
y.create.l HWIO_DBG_LOG_STATUS_ADDR A:0x4320c08
y.create.l HWIO_DBG_MUX_MASK_0_ADDR A:0x4320c0c
y.create.l HWIO_DBG_MUX_MASK_1_ADDR A:0x4320c10
y.create.l HWIO_DBG_MUX_MASK_2_ADDR A:0x4320c14
y.create.l HWIO_DBG_MUX_MASK_3_ADDR A:0x4320c18
y.create.l HWIO_DBG_MUX_MASK_4_ADDR A:0x4320c1c
y.create.l HWIO_DBG_MUX_MASK_5_ADDR A:0x4320c20
y.create.l HWIO_DBG_MUX_MASK_6_ADDR A:0x4320c24
y.create.l HWIO_DBG_MUX_MASK_7_ADDR A:0x4320c28
y.create.l HWIO_DBG_MUX_MASK_8_ADDR A:0x4320c2c
y.create.l HWIO_DBG_MUX_MASK_9_ADDR A:0x4320c30
y.create.l HWIO_DBG_PORT_MUX_ADDR A:0x4320c4c
y.create.l HWIO_DBG_ERR_IRQ_MASK0_ADDR A:0x4320c50
y.create.l HWIO_DBG_ERR_IRQ_MASK1_ADDR A:0x4320c54
y.create.l HWIO_DBG_SW_LOG_ADDR A:0x4320c58
y.create.l HWIO_DBG_DATA_DST_ADDR A:0x4320c5c
y.create.l HWIO_DBG_START_ADDR_ADDR A:0x4320c60
y.create.l HWIO_DBG_EXT_MEM_CNT_VAL_ADDR A:0x4320c64
y.create.l HWIO_DBG_SHRD_START_ADDR_ADDR A:0x4320c68
y.create.l HWIO_DBG_SHRD_END_ADDR_ADDR A:0x4320c6c
y.create.l HWIO_DBG_MAX_OST_BURSTS_ADDR A:0x4320c70
y.create.l HWIO_DBG_ERR_IRQ_EN0_ADDR A:0x4320c74
y.create.l HWIO_DBG_ERR_IRQ_EN1_ADDR A:0x4320c78
y.create.l HWIO_DBG_ERR_IRQ_CLR0_ADDR A:0x4320c7c
y.create.l HWIO_DBG_ERR_IRQ_CLR1_ADDR A:0x4320c80
y.create.l HWIO_DBG_ERR_IRQ_STATUS0_ADDR A:0x4320c84
y.create.l HWIO_DBG_ERR_IRQ_STATUS1_ADDR A:0x4320c88
y.create.l HWIO_MTC_BRDG_MCDMA_RD_ENABLE_ADDR A:0x432100c
y.create.l HWIO_MTC_BRDG_MCDMA_WR_ENABLE_ADDR A:0x4321010
y.create.l HWIO_MTC_BRDG_A2_RD_ENABLE_ADDR A:0x4321014
y.create.l HWIO_MTC_BRDG_CTL_ADDR A:0x4321000
y.create.l HWIO_MTC_BRDG_STATUS_ADDR A:0x4321004
y.create.l HWIO_MTC_BRDG_CLEAR_ADDR A:0x4321008
y.create.l HWIO_A2_SHRD_MEM_BASE_MIN_ADDR A:0x4322000
y.create.l HWIO_A2_SHRD_MEM_BASE_MAX_ADDR A:0x432367c
y.create.l HWIO_MCDMA_TS_STATUS_WORD0_ADDR A:0x4324000
y.create.l HWIO_MCDMA_TS_VBUF_CFG_WORD0_ADDR A:0x4324100
y.create.l HWIO_MCDMA_TS_VBUF_CFG_WORD1_ADDR A:0x4324104
y.create.l HWIO_MCDMA_TS_DMA_CH0_WORD0_ADDR A:0x4324200
y.create.l HWIO_MCDMA_TS_DMA_CH0_WORD1_ADDR A:0x4324204
y.create.l HWIO_MCDMA_TS_DMA_CH0_WORD2_ADDR A:0x4324208
y.create.l HWIO_MCDMA_TS_DMA_CH1_WORD0_ADDR A:0x4324300
y.create.l HWIO_MCDMA_TS_DMA_CH1_WORD1_ADDR A:0x4324304
y.create.l HWIO_MCDMA_TS_DMA_CH1_WORD2_ADDR A:0x4324308
y.create.l HWIO_MCDMA_TS_DMA_CH2_WORD0_ADDR A:0x4324400
y.create.l HWIO_MCDMA_TS_DMA_CH2_WORD1_ADDR A:0x4324404
y.create.l HWIO_MCDMA_TS_DMA_CH2_WORD2_ADDR A:0x4324408
y.create.l HWIO_MCDMA_TS_DMA_CH3_WORD0_ADDR A:0x4324500
y.create.l HWIO_MCDMA_TS_DMA_CH3_WORD1_ADDR A:0x4324504
y.create.l HWIO_MCDMA_TS_DMA_CH3_WORD2_ADDR A:0x4324508
y.create.l HWIO_DBG_STATUS_WORD0_ADDR A:0x4324800
y.create.l HWIO_DBG_TASK_WORD0_ADDR A:0x4324900
y.create.l HWIO_DBG_TASK_WORD1_ADDR A:0x4324904
y.create.l HWIO_UNIV_STMR_MSTMR_EXPY_ADDR A:0x4324c00
y.create.l HWIO_O_STMR_MSTMR_EXPY_ADDR A:0x4324c04
y.create.l HWIO_STMR_REF_COUNT_EXPY_ADDR A:0x4324c08
y.create.l HWIO_STMR_PROG_SNP_INT0_STATUS_ADDR A:0x4324c0c
y.create.l HWIO_STMR_PROG_SNP_INT1_STATUS_ADDR A:0x4324c10
y.create.l HWIO_STMR_PROG_SNP_INT0_CMD_ADDR A:0x4324c14
y.create.l HWIO_STMR_PROG_SNP_INT1_CMD_ADDR A:0x4324c18
y.create.l HWIO_STMR_PROG_SNP_INT0_SET_ADDR A:0x4324c1c
y.create.l HWIO_STMR_PROG_SNP_INT1_SET_ADDR A:0x4324c20
y.create.l HWIO_ENCRYPT_ACC_RESET_ADDR A:0x4325000
y.create.l HWIO_ENCRYPT_ACC_CGC_CTL_ADDR A:0x4325004
y.create.l HWIO_ENCRYPT_ACC_CGC_STATUS_ADDR A:0x4325008
y.create.l HWIO_GEA_CONFIG_0_ADDR A:0x432500c
y.create.l HWIO_GEA_INPUT_ADDR A:0x4325010
y.create.l HWIO_GEA_KC_0_ADDR A:0x4325014
y.create.l HWIO_GEA_KC_1_ADDR A:0x4325018
y.create.l HWIO_AMBA_KEY_STRM_WORD0_RD_ADDR A:0x432501c
y.create.l HWIO_AMBA_KEY_STRM_WORD1_RD_ADDR A:0x4325020
y.create.l HWIO_AMBA_KEY_STRM_WORD2_RD_ADDR A:0x4325024
y.create.l HWIO_AMBA_KEY_STRM_WORD3_RD_ADDR A:0x4325028
y.create.l HWIO_AMBA_KEY_STRM_WORD4_RD_ADDR A:0x432502c
y.create.l HWIO_AMBA_KEY_STRM_WORD5_RD_ADDR A:0x4325030
y.create.l HWIO_AMBA_KEY_STRM_WORD6_RD_ADDR A:0x4325034
y.create.l HWIO_AMBA_KEY_STRM_WORD7_RD_ADDR A:0x4325038
y.create.l HWIO_AMBA_KEY_STRM_STATUS_ADDR A:0x432503c
y.create.l HWIO_AFIVE_CONFIG_0_ADDR A:0x4325040
y.create.l HWIO_AFIVE_INPUT_ADDR A:0x4325044
y.create.l HWIO_AFIVE_KC_0_ADDR A:0x4325048
y.create.l HWIO_AFIVE_KC_1_ADDR A:0x432504c
y.create.l HWIO_AFIVE_KEY_STRM_WORD0_RD_ADDR A:0x4325050
y.create.l HWIO_AFIVE_KEY_STRM_WORD1_RD_ADDR A:0x4325054
y.create.l HWIO_AFIVE_KEY_STRM_WORD2_RD_ADDR A:0x4325058
y.create.l HWIO_AFIVE_KEY_STRM_WORD3_RD_ADDR A:0x432505c
y.create.l HWIO_AFIVE_KEY_STRM_WORD4_RD_ADDR A:0x4325060
y.create.l HWIO_AFIVE_KEY_STRM_WORD5_RD_ADDR A:0x4325064
y.create.l HWIO_AFIVE_KEY_STRM_WORD6_RD_ADDR A:0x4325068
y.create.l HWIO_AFIVE_KEY_STRM_WORD7_RD_ADDR A:0x432506c
y.create.l HWIO_AFIVE_KEY_STRM_WORD8_RD_ADDR A:0x4325070
y.create.l HWIO_AFIVE_KEY_STRM_WORD9_RD_ADDR A:0x4325074
y.create.l HWIO_O_STMR_RESET_ADDR A:0x4328000
y.create.l HWIO_O_STMR_ST_EVENT_CTL_ADDR A:0x4328004
y.create.l HWIO_O_STMR_FCW_ADDR A:0x4328008
y.create.l HWIO_O_STMR_MASK_CTL_ADDR A:0x432800c
y.create.l HWIO_O_STMR_ENABLE_ADDR A:0x4328010
y.create.l HWIO_O_STMR_TIMER_CMD_ADDR A:0x4328014
y.create.l HWIO_O_STMR_MSTMR_ADDR A:0x4328018
y.create.l HWIO_O_STMR_MSTMR_PHASE_ADDR A:0x4328098
y.create.l HWIO_O_STMR_MSTMR_LD_VALUE_ADDR A:0x432801c
y.create.l HWIO_O_STMR_MSTMR_WRAP_ADDR A:0x4328020
y.create.l HWIO_O_STMR_STROBE_CTL_0_ADDR A:0x4328024
y.create.l HWIO_O_STMR_STROBE_CTL_1_ADDR A:0x4328028
y.create.l HWIO_O_STMR_STROBE_CTL_2_ADDR A:0x432802c
y.create.l HWIO_O_STMR_STROBE_CTL_3_ADDR A:0x4328030
y.create.l HWIO_O_STMR_STROBE_CTL_4_ADDR A:0x4328034
y.create.l HWIO_O_STMR_STROBE_CTL_5_ADDR A:0x4328038
y.create.l HWIO_O_STMR_STROBE_CTL_6_ADDR A:0x432803c
y.create.l HWIO_O_STMR_STROBE_CTL_7_ADDR A:0x4328040
y.create.l HWIO_O_STMR_STROBE_CTL_8_ADDR A:0x4328044
y.create.l HWIO_O_STMR_STROBE_CTL_9_ADDR A:0x4328048
y.create.l HWIO_O_STMR_INT0_STATUS_ADDR A:0x4328064
y.create.l HWIO_O_STMR_INT0_CLR_ADDR A:0x4328068
y.create.l HWIO_O_STMR_INT1_STATUS_ADDR A:0x432806c
y.create.l HWIO_O_STMR_INT1_CLR_ADDR A:0x4328070
y.create.l HWIO_O_STMR_STATUS_DUMP_CMD_ADDR A:0x4328074
y.create.l HWIO_O_STMR_MSTMR_STATUS_ADDR A:0x4328078
y.create.l HWIO_O_STMR_MSTMR_PHASE_STATUS_ADDR A:0x432807c
y.create.l HWIO_TDS_STMR_ENABLE_ADDR A:0x4328400
y.create.l HWIO_TDS_STMR_STATUS_ADDR A:0x4328404
y.create.l HWIO_TDS_STMR_FCW_CTL_ADDR A:0x4328408
y.create.l HWIO_TDS_STMR_RESET_ADDR A:0x432840c
y.create.l HWIO_TDS_STMR_ST_EVENT_CMD_ADDR A:0x4328410
y.create.l HWIO_TDS_STMR_ST_EVENT_TIME_ADDR A:0x4328414
y.create.l HWIO_TDS_STMR_WALLTIME_COUNT_ADDR A:0x4328418
y.create.l HWIO_TDS_STMR_COMMON_PHASE_ADDR A:0x432841c
y.create.l HWIO_TDS_STMR_WALLTIME_CMD_ADDR A:0x4328420
y.create.l HWIO_TDS_STMR_WALL_TIME_MODIFIER_ADDR A:0x4328424
y.create.l HWIO_TDS_STMR_WALLTIME_INT_EVENT_0_ADDR A:0x4328428
y.create.l HWIO_TDS_STMR_WALLTIME_INT_EVENT_1_ADDR A:0x432842c
y.create.l HWIO_TDS_STMR_WALLTIME_INT_EVENT_2_ADDR A:0x4328430
y.create.l HWIO_TDS_STMR_WALLTIME_INT_EVENT_3_ADDR A:0x4328434
y.create.l HWIO_TDS_STMR_WALLTIME_INT_EVENT_4_ADDR A:0x4328438
y.create.l HWIO_TDS_STMR_WALLTIME_INT_EVENT_5_ADDR A:0x432843c
y.create.l HWIO_TDS_STMR_WALLTIME_INT_EVENT_6_ADDR A:0x4328440
y.create.l HWIO_TDS_STMR_WALLTIME_INT_EVENT_7_ADDR A:0x4328444
y.create.l HWIO_TDS_STMR_WALLTIME_INT_CMD_ADDR A:0x4328448
y.create.l HWIO_TDS_STMR_WALLTIME_INT_STATUS_ADDR A:0x432844c
y.create.l HWIO_TDS_STMR_RXTIME_COUNT_ADDR A:0x4328450
y.create.l HWIO_TDS_STMR_RXTIME_CMD_ADDR A:0x4328454
y.create.l HWIO_TDS_STMR_RX_TIME_MODIFIER_ADDR A:0x4328458
y.create.l HWIO_TDS_STMR_RXTIME_INT_EVENT_0_ADDR A:0x432845c
y.create.l HWIO_TDS_STMR_RXTIME_INT_EVENT_1_ADDR A:0x4328460
y.create.l HWIO_TDS_STMR_RXTIME_INT_EVENT_2_ADDR A:0x4328464
y.create.l HWIO_TDS_STMR_RXTIME_INT_EVENT_3_ADDR A:0x4328468
y.create.l HWIO_TDS_STMR_RXTIME_INT_EVENT_4_ADDR A:0x432846c
y.create.l HWIO_TDS_STMR_RXTIME_INT_EVENT_5_ADDR A:0x4328470
y.create.l HWIO_TDS_STMR_RXTIME_INT_EVENT_6_ADDR A:0x4328474
y.create.l HWIO_TDS_STMR_RXTIME_INT_EVENT_7_ADDR A:0x4328478
y.create.l HWIO_TDS_STMR_RXTIME_INT_EVENT_8_ADDR A:0x432847c
y.create.l HWIO_TDS_STMR_RXTIME_INT_EVENT_9_ADDR A:0x4328480
y.create.l HWIO_TDS_STMR_RXTIME_INT_STATUS_ADDR A:0x432849c
y.create.l HWIO_TDS_STMR_RXTIME_INT_CMD_ADDR A:0x43284a0
y.create.l HWIO_TDS_STMR_STATUS_DUMP_CMD_ADDR A:0x43284a4
y.create.l HWIO_TDS_STMR_WALLTIME_COUNT_STATUS_ADDR A:0x43284a8
y.create.l HWIO_TDS_STMR_COMMON_PHASE_STATUS_ADDR A:0x43284ac
y.create.l HWIO_TDS_STMR_RXTIME_COUNT_STATUS_ADDR A:0x43284b0
y.create.l HWIO_TDS_STMR_TIME_SYNC_CTL_ADDR A:0x43284b4
y.create.l HWIO_VFR_EVENT_ADDR A:0x43284e8
y.create.l HWIO_UNIV_STMR_RESET_ADDR A:0x4328800
y.create.l HWIO_UNIV_STMR_ENABLE_ADDR A:0x4328804
y.create.l HWIO_UNIV_STMR_MSTMR_ADDR A:0x4328808
y.create.l HWIO_UNIV_STMR_SYNC_CMD_ADDR A:0x432880c
y.create.l HWIO_UNIV_STMR_MODIFIER_ADJ_ADDR A:0x4328810
y.create.l HWIO_UNIV_STMR_STATUS_ADDR A:0x4328814
y.create.l HWIO_SYS_ONLINE_CTRL0_ADDR A:0x4328a00
y.create.l HWIO_SYS_ONLINE_CTRL1_ADDR A:0x4328a04
y.create.l HWIO_SYS_ONLINE_CTRL2_ADDR A:0x4328a08
y.create.l HWIO_SYS_ONLINE_CMD0_ADDR A:0x4328a10
y.create.l HWIO_SYS_ONLINE_CMD1_ADDR A:0x4328a14
y.create.l HWIO_SYS_ONLINE_CMD2_ADDR A:0x4328a18
y.create.l HWIO_SYS_ONLINE_TIME0_ADDR A:0x4328a20
y.create.l HWIO_SYS_ONLINE_TIME1_ADDR A:0x4328a24
y.create.l HWIO_SYS_ONLINE_TIME2_ADDR A:0x4328a28
y.create.l HWIO_SYS_ONLINE_STATUS_ADDR A:0x4328a30
y.create.l HWIO_UNIV_STMR_STATUS_DUMP_CMD_ADDR A:0x4328834
y.create.l HWIO_UNIV_STMR_TIME_STATUS_RD_ADDR A:0x4328838
y.create.l HWIO_O_STMR_TIME_STATUS_RD_ADDR A:0x432883c
y.create.l HWIO_O_STMR_PHASE_STATUS_RD_ADDR A:0x4328840
y.create.l HWIO_UMTS_STMR_TIME_STATUS_RD_ADDR A:0x4328860
y.create.l HWIO_UMTS_TX_TIME_STATUS_RD_ADDR A:0x4328864
y.create.l HWIO_UMTS_STMR_PHASE_STATUS_RD_ADDR A:0x4328868
y.create.l HWIO_TDS_WALLTIME_STATUS_RD_ADDR A:0x432886c
y.create.l HWIO_TDS_RXTIME_STATUS_RD_ADDR A:0x4328870
y.create.l HWIO_TDS_PHASE_STATUS_RD_ADDR A:0x4328874
y.create.l HWIO_TX_C0_CTRL_SEL_ADDR A:0x4328880
y.create.l HWIO_TX_C1_CTRL_SEL_ADDR A:0x4328884
y.create.l HWIO_TX_C0_TRIG_CMD_ADDR A:0x4328888
y.create.l HWIO_TX_C1_TRIG_CMD_ADDR A:0x432888c
y.create.l HWIO_TX_C0_TRIG_VAL_ADDR A:0x4328890
y.create.l HWIO_TX_C1_TRIG_VAL_ADDR A:0x4328894
y.create.l HWIO_TX_TRIG_STATUS_ADDR A:0x43288a8
y.create.l HWIO_TX_C0_TRIG_RD_ADDR A:0x43288b0
y.create.l HWIO_TX_C1_TRIG_RD_ADDR A:0x43288b4
y.create.l HWIO_UNIV_STMR_TX_SYNC_TIME0_ADDR A:0x43288d0
y.create.l HWIO_UNIV_STMR_TX_SYNC_TIME1_ADDR A:0x43288d4
y.create.l HWIO_UNIV_STMR_TRIG_CTRL_ADDR A:0x43288d8
y.create.l HWIO_UNIV_STMR_TRIG_MASK_ADDR A:0x43288dc
y.create.l HWIO_VFR_SEL_ADDR A:0x43288e0
y.create.l HWIO_VFR_SEL_1_ADDR A:0x4328904
y.create.l HWIO_UNIV_STMR_SPARE_ADDR A:0x43288e4
y.create.l HWIO_SYS_SLEEP_STATUS_ADDR A:0x43288e8
y.create.l HWIO_UNIV_STMR_LD_CMD_ADDR A:0x43288ec
y.create.l HWIO_UNIV_STMR_MODIFIER_LD_ADDR A:0x43288f0
y.create.l HWIO_TX_DAC0_UPDATE_STRT_TRIG_CMD_ADDR A:0x4328908
y.create.l HWIO_TX_DAC1_UPDATE_STRT_TRIG_CMD_ADDR A:0x432890c
y.create.l HWIO_TX_DAC0_UPDATE_STRT_VAL_ADDR A:0x4328910
y.create.l HWIO_TX_DAC1_UPDATE_STRT_VAL_ADDR A:0x4328914
y.create.l HWIO_TX_DAC0_UPDATE_STOP_TRIG_CMD_ADDR A:0x4328918
y.create.l HWIO_TX_DAC1_UPDATE_STOP_TRIG_CMD_ADDR A:0x432891c
y.create.l HWIO_TX_DAC0_UPDATE_STOP_VAL_ADDR A:0x4328920
y.create.l HWIO_TX_DAC1_UPDATE_STOP_VAL_ADDR A:0x4328924
y.create.l HWIO_TX_DAC0_IREF_GAIN_ADDR A:0x4328928
y.create.l HWIO_TX_DAC1_IREF_GAIN_ADDR A:0x432892c
y.create.l HWIO_DACCOMP_MUX_CHAIN0_STRT_TRIG_CMD_ADDR A:0x4328930
y.create.l HWIO_DACCOMP_MUX_CHAIN1_STRT_TRIG_CMD_ADDR A:0x4328934
y.create.l HWIO_DACCOMP_MUX_CHAIN0_STRT_VAL_ADDR A:0x4328938
y.create.l HWIO_DACCOMP_MUX_CHAIN1_STRT_VAL_ADDR A:0x432893c
y.create.l HWIO_DACCOMP_MUX_CHAIN0_STOP_TRIG_CMD_ADDR A:0x4328940
y.create.l HWIO_DACCOMP_MUX_CHAIN1_STOP_TRIG_CMD_ADDR A:0x4328944
y.create.l HWIO_DACCOMP_MUX_CHAIN0_STOP_VAL_ADDR A:0x4328948
y.create.l HWIO_DACCOMP_MUX_CHAIN1_STOP_VAL_ADDR A:0x432894c
y.create.l HWIO_DACCOMP_MUX_CHAIN0_STRT_TRIG_RD_ADDR A:0x4328950
y.create.l HWIO_DACCOMP_MUX_CHAIN1_STRT_TRIG_RD_ADDR A:0x4328954
y.create.l HWIO_DACCOMP_MUX_CHAIN0_STOP_TRIG_RD_ADDR A:0x4328958
y.create.l HWIO_DACCOMP_MUX_CHAIN1_STOP_TRIG_RD_ADDR A:0x432895c
y.create.l HWIO_RXFE_C0_TRIG_CMD_ADDR A:0x4328980
y.create.l HWIO_RXFE_C1_TRIG_CMD_ADDR A:0x4328984
y.create.l HWIO_RXFE_C2_TRIG_CMD_ADDR A:0x4328988
y.create.l HWIO_RXFE_C3_TRIG_CMD_ADDR A:0x432898c
y.create.l HWIO_RXFE_C0_TRIG_VAL_ADDR A:0x43289a0
y.create.l HWIO_RXFE_C1_TRIG_VAL_ADDR A:0x43289a4
y.create.l HWIO_RXFE_C2_TRIG_VAL_ADDR A:0x43289a8
y.create.l HWIO_RXFE_C3_TRIG_VAL_ADDR A:0x43289ac
y.create.l HWIO_RXFE_TRIG_STATUS_ADDR A:0x43289c0
y.create.l HWIO_RXFE_C0_TRIG_RD_ADDR A:0x43289d0
y.create.l HWIO_RXFE_C1_TRIG_RD_ADDR A:0x43289d4
y.create.l HWIO_RXFE_C2_TRIG_RD_ADDR A:0x43289d8
y.create.l HWIO_RXFE_C3_TRIG_RD_ADDR A:0x43289dc
y.create.l HWIO_STMR_TIME_RD_ADDR A:0x4328b00
y.create.l HWIO_STMR_EVT_MATCH_0_ADDR A:0x4328b04
y.create.l HWIO_STMR_EVT_MATCH_1_ADDR A:0x4328b08
y.create.l HWIO_STMR_EVT_MATCH_2_ADDR A:0x4328b0c
y.create.l HWIO_STMR_EVT_MATCH_3_ADDR A:0x4328b10
y.create.l HWIO_STMR_EVT_MATCH_4_ADDR A:0x4328b14
y.create.l HWIO_STMR_EVT_MATCH_5_ADDR A:0x4328b18
y.create.l HWIO_STMR_EVT_MATCH_6_ADDR A:0x4328b1c
y.create.l HWIO_STMR_EVT_MATCH_7_ADDR A:0x4328b20
y.create.l HWIO_STMR_EVT_MATCH_8_ADDR A:0x4328b24
y.create.l HWIO_STMR_EVT_MATCH_9_ADDR A:0x4328b28
y.create.l HWIO_UMTS_STMR_ENABLE_ADDR A:0x4329000
y.create.l HWIO_UMTS_STMR_STATUS_ADDR A:0x4329004
y.create.l HWIO_STMR_FCW_CTL_ADDR A:0x4329008
y.create.l HWIO_STMR_RESET_ADDR A:0x432900c
y.create.l HWIO_STMR_ST_EVENT_CTL_ADDR A:0x4329010
y.create.l HWIO_STMR_TIME_CMD_PRI_ADDR A:0x4329014
y.create.l HWIO_STMR_WALL_TIME_MODIFIER_ADDR A:0x4329018
y.create.l HWIO_STMR_STATUS_DUMP_CMD_PRI_ADDR A:0x432901c
y.create.l HWIO_STMR_REF_COUNT_STATUS_PRI_ADDR A:0x4329020
y.create.l HWIO_STMR_TX_TIME_STATUS_PRI_ADDR A:0x4329024
y.create.l HWIO_STMR_C0_COUNT_STATUS_ADDR A:0x4329028
y.create.l HWIO_STMR_C1_COUNT_STATUS_ADDR A:0x432902c
y.create.l HWIO_STMR_C2_COUNT_STATUS_ADDR A:0x4329030
y.create.l HWIO_STMR_PHASE_PRI_ADDR A:0x4329038
y.create.l HWIO_STMR_REF_COUNT_ADDR A:0x432903c
y.create.l HWIO_STMR_REF_PHASE_ADDR A:0x4329318
y.create.l HWIO_STMR_COMBINER_COUNT0_PRI_ADDR A:0x4329040
y.create.l HWIO_STMR_COMBINER_COUNT1_PRI_ADDR A:0x4329044
y.create.l HWIO_STMR_COMBINER_COUNT2_PRI_ADDR A:0x4329048
y.create.l HWIO_STMR_CFN_COUNT0_ADDR A:0x4329050
y.create.l HWIO_STMR_CFN_COUNT1_ADDR A:0x4329054
y.create.l HWIO_STMR_CFN_COUNT2_ADDR A:0x4329058
y.create.l HWIO_STMR_TIME_SYNC_CTL_ADDR A:0x4329060
y.create.l HWIO_STMR_CN_MODIFIER_ON_LINE_ADDR A:0x4329064
y.create.l HWIO_STMR_MISC_CTL_ADDR A:0x4329068
y.create.l HWIO_STMR_TX_10MS_INT_OFFSET_ADDR A:0x432906c
y.create.l HWIO_STMR_PROG_INT0_STATUS_ADDR A:0x4329070
y.create.l HWIO_STMR_PROG_INT1_STATUS_ADDR A:0x4329074
y.create.l HWIO_STMR_PROG_INT2_STATUS_ADDR A:0x4329078
y.create.l HWIO_STMR_PROG_INT0_CMD_ADDR A:0x4329080
y.create.l HWIO_STMR_PROG_INT1_CMD_ADDR A:0x4329084
y.create.l HWIO_STMR_PROG_INT2_CMD_ADDR A:0x4329088
y.create.l HWIO_STMR_PROG_INT0_CTL_ADDR A:0x4329090
y.create.l HWIO_STMR_PROG_INT1_CTL_ADDR A:0x4329094
y.create.l HWIO_STMR_PROG_INT2_CTL_ADDR A:0x4329098
y.create.l HWIO_STMR_INT0_EVENT_0_ADDR A:0x43290a0
y.create.l HWIO_STMR_INT0_EVENT_1_ADDR A:0x43290a4
y.create.l HWIO_STMR_INT0_EVENT_2_ADDR A:0x43290a8
y.create.l HWIO_STMR_INT0_EVENT_3_ADDR A:0x43290ac
y.create.l HWIO_STMR_INT0_EVENT_4_ADDR A:0x43290b0
y.create.l HWIO_STMR_INT0_EVENT_5_ADDR A:0x43290b4
y.create.l HWIO_STMR_INT0_EVENT_6_ADDR A:0x43290b8
y.create.l HWIO_STMR_INT0_EVENT_7_ADDR A:0x43290bc
y.create.l HWIO_STMR_INT0_EVENT_8_ADDR A:0x43290c0
y.create.l HWIO_STMR_INT0_EVENT_9_ADDR A:0x43290c4
y.create.l HWIO_STMR_INT1_EVENT_0_ADDR A:0x43290e0
y.create.l HWIO_STMR_INT1_EVENT_1_ADDR A:0x43290e4
y.create.l HWIO_STMR_INT1_EVENT_2_ADDR A:0x43290e8
y.create.l HWIO_STMR_INT1_EVENT_3_ADDR A:0x43290ec
y.create.l HWIO_STMR_INT1_EVENT_4_ADDR A:0x43290f0
y.create.l HWIO_STMR_INT1_EVENT_5_ADDR A:0x43290f4
y.create.l HWIO_STMR_INT1_EVENT_6_ADDR A:0x43290f8
y.create.l HWIO_STMR_INT1_EVENT_7_ADDR A:0x43290fc
y.create.l HWIO_STMR_INT1_EVENT_8_ADDR A:0x4329100
y.create.l HWIO_STMR_INT1_EVENT_9_ADDR A:0x4329104
y.create.l HWIO_STMR_INT2_EVENT_0_ADDR A:0x4329120
y.create.l HWIO_STMR_INT2_EVENT_1_ADDR A:0x4329124
y.create.l HWIO_STMR_INT2_EVENT_2_ADDR A:0x4329128
y.create.l HWIO_STMR_INT2_EVENT_3_ADDR A:0x432912c
y.create.l HWIO_STMR_INT2_EVENT_4_ADDR A:0x4329130
y.create.l HWIO_STMR_INT2_EVENT_5_ADDR A:0x4329134
y.create.l HWIO_STMR_INT2_EVENT_6_ADDR A:0x4329138
y.create.l HWIO_STMR_INT2_EVENT_7_ADDR A:0x432913c
y.create.l HWIO_STMR_INT2_EVENT_8_ADDR A:0x4329140
y.create.l HWIO_STMR_INT2_EVENT_9_ADDR A:0x4329144
y.create.l HWIO_STMR_TIME_CMD_SNP_ADDR A:0x43291a0
y.create.l HWIO_STMR_TX_TARGET_REF_COUNT_ADDR A:0x43291ac
y.create.l HWIO_STMR_TX_TIME_MODIFIER_ADDR A:0x43291b0
y.create.l HWIO_STMR_COMBINER_CMD_SNP_ADDR A:0x43291b4
y.create.l HWIO_STMR_C0_TARGET_REF_COUNT_ADDR A:0x43291b8
y.create.l HWIO_STMR_C1_TARGET_REF_COUNT_ADDR A:0x43291bc
y.create.l HWIO_STMR_C2_TARGET_REF_COUNT_ADDR A:0x43291c0
y.create.l HWIO_STMR_CFN0_MODIFIER_ADDR A:0x4329308
y.create.l HWIO_STMR_CFN1_MODIFIER_ADDR A:0x432930c
y.create.l HWIO_STMR_CFN2_MODIFIER_ADDR A:0x4329310
y.create.l HWIO_STMR_C0_MODIFIER_ADDR A:0x43291c8
y.create.l HWIO_STMR_C1_MODIFIER_ADDR A:0x43291cc
y.create.l HWIO_STMR_C2_MODIFIER_ADDR A:0x43291d0
y.create.l HWIO_STMR_STATUS_DUMP_CMD_SNP_ADDR A:0x43291d8
y.create.l HWIO_STMR_TX_TIME_STATUS_SNP_ADDR A:0x43291dc
y.create.l HWIO_STMR_REF_COUNT_STATUS_SNP_ADDR A:0x43291e0
y.create.l HWIO_STMR_PHASE_SNP_ADDR A:0x43291e8
y.create.l HWIO_STMR_TX_TIME_SNP_ADDR A:0x43291ec
y.create.l HWIO_STMR_PROG_SNP_INT0_CTL_ADDR A:0x4329218
y.create.l HWIO_STMR_PROG_SNP_INT1_CTL_ADDR A:0x432921c
y.create.l HWIO_STMR_SNP_INT0_EVENT_0_ADDR A:0x4329224
y.create.l HWIO_STMR_SNP_INT0_EVENT_1_ADDR A:0x4329228
y.create.l HWIO_STMR_SNP_INT0_EVENT_2_ADDR A:0x432922c
y.create.l HWIO_STMR_SNP_INT0_EVENT_3_ADDR A:0x4329230
y.create.l HWIO_STMR_SNP_INT0_EVENT_4_ADDR A:0x4329234
y.create.l HWIO_STMR_SNP_INT0_EVENT_5_ADDR A:0x4329238
y.create.l HWIO_STMR_SNP_INT0_EVENT_6_ADDR A:0x432923c
y.create.l HWIO_STMR_SNP_INT0_EVENT_7_ADDR A:0x4329240
y.create.l HWIO_STMR_SNP_INT1_EVENT_0_ADDR A:0x4329264
y.create.l HWIO_STMR_SNP_INT1_EVENT_1_ADDR A:0x4329268
y.create.l HWIO_STMR_SNP_INT1_EVENT_2_ADDR A:0x432926c
y.create.l HWIO_STMR_SNP_INT1_EVENT_3_ADDR A:0x4329270
y.create.l HWIO_OCIMEM_HW_VERSION_ADDR A:0x50000
y.create.l HWIO_OCIMEM_HW_PROFILE_ADDR A:0x50004
y.create.l HWIO_OCIMEM_GEN_CTL_ADDR A:0x50008
y.create.l HWIO_OCIMEM_GEN_STAT_ADDR A:0x5000c
y.create.l HWIO_OCIMEM_INTC_CLR_ADDR A:0x50010
y.create.l HWIO_OCIMEM_INTC_MASK_ADDR A:0x50014
y.create.l HWIO_OCIMEM_INTC_STAT_ADDR A:0x50018
y.create.l HWIO_OCIMEM_OSW_STATUS_ADDR A:0x5001c
y.create.l HWIO_OCIMEM_PSCGC_TIMERS_ADDR A:0x50034
y.create.l HWIO_OCIMEM_PSCGC_STAT_ADDR A:0x50038
y.create.l HWIO_OCIMEM_PSCGC_M0_M7_CTL_ADDR A:0x5003c
y.create.l HWIO_OCIMEM_ERR_ADDRESS_ADDR A:0x50060
y.create.l HWIO_OCIMEM_AXI_ERR_SYNDROME_ADDR A:0x50064
y.create.l HWIO_OCIMEM_DEBUG_CTL_ADDR A:0x50068
y.create.l HWIO_OCIMEM_MPU_XPU_SCR_ADDR A:0x53000
y.create.l HWIO_OCIMEM_MPU_XPU_SWDR_ADDR A:0x53004
y.create.l HWIO_OCIMEM_MPU_XPU_PRTN_RACR_SSHADOW_ADDR A:0x53008
y.create.l HWIO_OCIMEM_MPU_XPU_PRTN_WACR_SSHADOW_ADDR A:0x5300c
y.create.l HWIO_OCIMEM_MPU_XPU_PRTN_START_SSHADOW0_ADDR A:0x53010
y.create.l HWIO_OCIMEM_MPU_XPU_PRTN_END_SSHADOW0_ADDR A:0x53018
y.create.l HWIO_OCIMEM_MPU_XPU_SEAR0_ADDR A:0x53040
y.create.l HWIO_OCIMEM_MPU_XPU_SESR_ADDR A:0x53048
y.create.l HWIO_OCIMEM_MPU_XPU_SESRRESTORE_ADDR A:0x5304c
y.create.l HWIO_OCIMEM_MPU_XPU_SESYNR0_ADDR A:0x53050
y.create.l HWIO_OCIMEM_MPU_XPU_SESYNR1_ADDR A:0x53054
y.create.l HWIO_OCIMEM_MPU_XPU_SESYNR2_ADDR A:0x53058
y.create.l HWIO_OCIMEM_MPU_XPU_MCR_ADDR A:0x53100
y.create.l HWIO_OCIMEM_MPU_XPU_MEAR0_ADDR A:0x53140
y.create.l HWIO_OCIMEM_MPU_XPU_MESR_ADDR A:0x53148
y.create.l HWIO_OCIMEM_MPU_XPU_MESRRESTORE_ADDR A:0x5314c
y.create.l HWIO_OCIMEM_MPU_XPU_MESYNR0_ADDR A:0x53150
y.create.l HWIO_OCIMEM_MPU_XPU_MESYNR1_ADDR A:0x53154
y.create.l HWIO_OCIMEM_MPU_XPU_MESYNR2_ADDR A:0x53158
y.create.l HWIO_OCIMEM_MPU_XPU_CR_ADDR A:0x53080
y.create.l HWIO_OCIMEM_MPU_XPU_PRTN_RACR_SHADOW_ADDR A:0x53088
y.create.l HWIO_OCIMEM_MPU_XPU_PRTN_WACR_SHADOW_ADDR A:0x5308c
y.create.l HWIO_OCIMEM_MPU_XPU_PRTN_START_SHADOW0_ADDR A:0x53090
y.create.l HWIO_OCIMEM_MPU_XPU_PRTN_END_SHADOW0_ADDR A:0x53098
y.create.l HWIO_OCIMEM_MPU_XPU_RPU_ACR0_ADDR A:0x530a0
y.create.l HWIO_OCIMEM_MPU_XPU_EAR0_ADDR A:0x530c0
y.create.l HWIO_OCIMEM_MPU_XPU_ESR_ADDR A:0x530c8
y.create.l HWIO_OCIMEM_MPU_XPU_ESRRESTORE_ADDR A:0x530cc
y.create.l HWIO_OCIMEM_MPU_XPU_ESYNR0_ADDR A:0x530d0
y.create.l HWIO_OCIMEM_MPU_XPU_ESYNR1_ADDR A:0x530d4
y.create.l HWIO_OCIMEM_MPU_XPU_ESYNR2_ADDR A:0x530d8
y.create.l HWIO_OCIMEM_MPU_XPU_UMR_RACR_ADDR A:0x530e0
y.create.l HWIO_OCIMEM_MPU_XPU_UMR_WACR_ADDR A:0x530e4
y.create.l HWIO_OCIMEM_MPU_XPU_UMR_CNTL_ADDR A:0x530f0
y.create.l HWIO_OCIMEM_MPU_XPU_IDR0_ADDR A:0x53074
y.create.l HWIO_OCIMEM_MPU_XPU_IDR1_ADDR A:0x53078
y.create.l HWIO_OCIMEM_MPU_XPU_REV_ADDR A:0x5307c
y.create.l HWIO_OCIMEM_MPU_XPU_PRT0_RACR0_ADDR A:0x53200
y.create.l HWIO_OCIMEM_MPU_XPU_PRT1_RACR0_ADDR A:0x53280
y.create.l HWIO_OCIMEM_MPU_XPU_PRT2_RACR0_ADDR A:0x53300
y.create.l HWIO_OCIMEM_MPU_XPU_PRT3_RACR0_ADDR A:0x53380
y.create.l HWIO_OCIMEM_MPU_XPU_PRT4_RACR0_ADDR A:0x53400
y.create.l HWIO_OCIMEM_MPU_XPU_PRT5_RACR0_ADDR A:0x53480
y.create.l HWIO_OCIMEM_MPU_XPU_PRT6_RACR0_ADDR A:0x53500
y.create.l HWIO_OCIMEM_MPU_XPU_PRT7_RACR0_ADDR A:0x53580
y.create.l HWIO_OCIMEM_MPU_XPU_PRT0_WACR0_ADDR A:0x53220
y.create.l HWIO_OCIMEM_MPU_XPU_PRT1_WACR0_ADDR A:0x532a0
y.create.l HWIO_OCIMEM_MPU_XPU_PRT2_WACR0_ADDR A:0x53320
y.create.l HWIO_OCIMEM_MPU_XPU_PRT3_WACR0_ADDR A:0x533a0
y.create.l HWIO_OCIMEM_MPU_XPU_PRT4_WACR0_ADDR A:0x53420
y.create.l HWIO_OCIMEM_MPU_XPU_PRT5_WACR0_ADDR A:0x534a0
y.create.l HWIO_OCIMEM_MPU_XPU_PRT6_WACR0_ADDR A:0x53520
y.create.l HWIO_OCIMEM_MPU_XPU_PRT7_WACR0_ADDR A:0x535a0
y.create.l HWIO_OCIMEM_MPU_XPU_PRT0_START0_ADDR A:0x53240
y.create.l HWIO_OCIMEM_MPU_XPU_PRT1_START0_ADDR A:0x532c0
y.create.l HWIO_OCIMEM_MPU_XPU_PRT2_START0_ADDR A:0x53340
y.create.l HWIO_OCIMEM_MPU_XPU_PRT3_START0_ADDR A:0x533c0
y.create.l HWIO_OCIMEM_MPU_XPU_PRT4_START0_ADDR A:0x53440
y.create.l HWIO_OCIMEM_MPU_XPU_PRT5_START0_ADDR A:0x534c0
y.create.l HWIO_OCIMEM_MPU_XPU_PRT6_START0_ADDR A:0x53540
y.create.l HWIO_OCIMEM_MPU_XPU_PRT7_START0_ADDR A:0x535c0
y.create.l HWIO_OCIMEM_MPU_XPU_PRT0_END0_ADDR A:0x53248
y.create.l HWIO_OCIMEM_MPU_XPU_PRT1_END0_ADDR A:0x532c8
y.create.l HWIO_OCIMEM_MPU_XPU_PRT2_END0_ADDR A:0x53348
y.create.l HWIO_OCIMEM_MPU_XPU_PRT3_END0_ADDR A:0x533c8
y.create.l HWIO_OCIMEM_MPU_XPU_PRT4_END0_ADDR A:0x53448
y.create.l HWIO_OCIMEM_MPU_XPU_PRT5_END0_ADDR A:0x534c8
y.create.l HWIO_OCIMEM_MPU_XPU_PRT6_END0_ADDR A:0x53548
y.create.l HWIO_OCIMEM_MPU_XPU_PRT7_END0_ADDR A:0x535c8
y.create.l HWIO_OCIMEM_MPU_XPU_PRT0_SCR_ADDR A:0x53250
y.create.l HWIO_OCIMEM_MPU_XPU_PRT1_SCR_ADDR A:0x532d0
y.create.l HWIO_OCIMEM_MPU_XPU_PRT2_SCR_ADDR A:0x53350
y.create.l HWIO_OCIMEM_MPU_XPU_PRT3_SCR_ADDR A:0x533d0
y.create.l HWIO_OCIMEM_MPU_XPU_PRT4_SCR_ADDR A:0x53450
y.create.l HWIO_OCIMEM_MPU_XPU_PRT5_SCR_ADDR A:0x534d0
y.create.l HWIO_OCIMEM_MPU_XPU_PRT6_SCR_ADDR A:0x53550
y.create.l HWIO_OCIMEM_MPU_XPU_PRT7_SCR_ADDR A:0x535d0
y.create.l HWIO_OCIMEM_MPU_XPU_PRT0_MCR_ADDR A:0x53254
y.create.l HWIO_OCIMEM_MPU_XPU_PRT1_MCR_ADDR A:0x532d4
y.create.l HWIO_OCIMEM_MPU_XPU_PRT2_MCR_ADDR A:0x53354
y.create.l HWIO_OCIMEM_MPU_XPU_PRT3_MCR_ADDR A:0x533d4
y.create.l HWIO_OCIMEM_MPU_XPU_PRT4_MCR_ADDR A:0x53454
y.create.l HWIO_OCIMEM_MPU_XPU_PRT5_MCR_ADDR A:0x534d4
y.create.l HWIO_OCIMEM_MPU_XPU_PRT6_MCR_ADDR A:0x53554
y.create.l HWIO_OCIMEM_MPU_XPU_PRT7_MCR_ADDR A:0x535d4
y.create.l HWIO_OCIMEM_MPU_XPU_PRT0_CNTL0_ADDR A:0x53258
y.create.l HWIO_OCIMEM_MPU_XPU_PRT1_CNTL0_ADDR A:0x532d8
y.create.l HWIO_OCIMEM_MPU_XPU_PRT2_CNTL0_ADDR A:0x53358
y.create.l HWIO_OCIMEM_MPU_XPU_PRT3_CNTL0_ADDR A:0x533d8
y.create.l HWIO_OCIMEM_MPU_XPU_PRT4_CNTL0_ADDR A:0x53458
y.create.l HWIO_OCIMEM_MPU_XPU_PRT5_CNTL0_ADDR A:0x534d8
y.create.l HWIO_OCIMEM_MPU_XPU_PRT6_CNTL0_ADDR A:0x53558
y.create.l HWIO_OCIMEM_MPU_XPU_PRT7_CNTL0_ADDR A:0x535d8
y.create.l HWIO_OCIMEM_MPU_XPU_PRT0_CNTL1_ADDR A:0x5325c
y.create.l HWIO_OCIMEM_MPU_XPU_PRT1_CNTL1_ADDR A:0x532dc
y.create.l HWIO_OCIMEM_MPU_XPU_PRT2_CNTL1_ADDR A:0x5335c
y.create.l HWIO_OCIMEM_MPU_XPU_PRT3_CNTL1_ADDR A:0x533dc
y.create.l HWIO_OCIMEM_MPU_XPU_PRT4_CNTL1_ADDR A:0x5345c
y.create.l HWIO_OCIMEM_MPU_XPU_PRT5_CNTL1_ADDR A:0x534dc
y.create.l HWIO_OCIMEM_MPU_XPU_PRT6_CNTL1_ADDR A:0x5355c
y.create.l HWIO_OCIMEM_MPU_XPU_PRT7_CNTL1_ADDR A:0x535dc
y.create.l HWIO_OXILI_RBBM_HW_VERSION_ADDR A:0x1c00000
y.create.l HWIO_OXILI_RBBM_HW_RELEASE_ADDR A:0x1c00004
y.create.l HWIO_OXILI_RBBM_HW_CONFIGURATION_ADDR A:0x1c00008
y.create.l HWIO_OXILI_RBBM_CLOCK_CTL_ADDR A:0x1c00040
y.create.l HWIO_OXILI_RBBM_CLOCK_CTL1_ADDR A:0x1c0004c
y.create.l HWIO_OXILI_RBBM_CLOCK_STATUS_ADDR A:0x1c00044
y.create.l HWIO_OXILI_RBBM_SP_HYST_CNT_ADDR A:0x1c00048
y.create.l HWIO_OXILI_RBBM_SW_RESET_CMD_ADDR A:0x1c00060
y.create.l HWIO_OXILI_RBBM_AHB_CTL0_ADDR A:0x1c00080
y.create.l HWIO_OXILI_RBBM_AHB_CTL1_ADDR A:0x1c00084
y.create.l HWIO_OXILI_RBBM_AHB_CMD_ADDR A:0x1c00088
y.create.l HWIO_OXILI_RBBM_AHB_STATUS_ADDR A:0x1c0008c
y.create.l HWIO_OXILI_RBBM_AHB_TXFR_TIMEOUT_STATUS_ADDR A:0x1c00090
y.create.l HWIO_OXILI_RBBM_AHB_ME_SPLIT_STATUS_ADDR A:0x1c00094
y.create.l HWIO_OXILI_RBBM_AHB_PFP_SPLIT_STATUS_ADDR A:0x1c00098
y.create.l HWIO_OXILI_RBBM_AHB_ERROR_STATUS_ADDR A:0x1c0009c
y.create.l HWIO_OXILI_RBBM_RB_SUB_BLOCK_SEL_CTL_ADDR A:0x1c000a4
y.create.l HWIO_OXILI_RBBM_GFX_COPY_CMD_ADDR A:0x1c000a8
y.create.l HWIO_OXILI_RBBM_GFX_COPY_STATUS_ADDR A:0x1c000ac
y.create.l HWIO_OXILI_RBBM_RAM_ACC_63_32_ADDR A:0x1c000b4
y.create.l HWIO_OXILI_RBBM_GPR0_CTL_ADDR A:0x1c000b8
y.create.l HWIO_OXILI_RBBM_GPR1_CTL_ADDR A:0x1c000bc
y.create.l HWIO_OXILI_RBBM_STATUS_ADDR A:0x1c000c0
y.create.l HWIO_OXILI_RBBM_STATUS1_ADDR A:0x1c000c4
y.create.l HWIO_OXILI_RBBM_STATUS2_ADDR A:0x1c000c8
y.create.l HWIO_OXILI_RBBM_WAIT_IDLE_CLOCKS_CTL_ADDR A:0x1c000cc
y.create.l HWIO_OXILI_RBBM_WAIT_FOR_GPU_IDLE_CMD_ADDR A:0x1c00100
y.create.l HWIO_OXILI_RBBM_WAIT_UNTIL_CMD_ADDR A:0x1c00104
y.create.l HWIO_OXILI_RBBM_WAIT_UNTIL_CTL_ADDR A:0x1c00108
y.create.l HWIO_OXILI_RBBM_INTERFACE_HANG_INT_CTL_ADDR A:0x1c00140
y.create.l HWIO_OXILI_RBBM_INTERFACE_HANG_MASK_CTL0_ADDR A:0x1c00144
y.create.l HWIO_OXILI_RBBM_INTERFACE_HANG_MASK_CTL1_ADDR A:0x1c00150
y.create.l HWIO_OXILI_RBBM_INTERFACE_HANG_MASK_CTL2_ADDR A:0x1c0015c
y.create.l HWIO_OXILI_RBBM_INTERFACE_HANG_MASK_CTL3_ADDR A:0x1c00168
y.create.l HWIO_OXILI_RBBM_INTERFACE_SRDY_STATUS0_ADDR A:0x1c00148
y.create.l HWIO_OXILI_RBBM_INTERFACE_SRDY_STATUS1_ADDR A:0x1c00154
y.create.l HWIO_OXILI_RBBM_INTERFACE_SRDY_STATUS2_ADDR A:0x1c00160
y.create.l HWIO_OXILI_RBBM_INTERFACE_SRDY_STATUS3_ADDR A:0x1c0016c
y.create.l HWIO_OXILI_RBBM_INTERFACE_RRDY_STATUS0_ADDR A:0x1c0014c
y.create.l HWIO_OXILI_RBBM_INTERFACE_RRDY_STATUS1_ADDR A:0x1c00158
y.create.l HWIO_OXILI_RBBM_INTERFACE_RRDY_STATUS2_ADDR A:0x1c00164
y.create.l HWIO_OXILI_RBBM_INTERFACE_RRDY_STATUS3_ADDR A:0x1c00170
y.create.l HWIO_OXILI_RBBM_INT_SET_CMD_ADDR A:0x1c00180
y.create.l HWIO_OXILI_RBBM_INT_CLEAR_CMD_ADDR A:0x1c00184
y.create.l HWIO_OXILI_RBBM_INT_UNMASKED_STATUS_ADDR A:0x1c00188
y.create.l HWIO_OXILI_RBBM_INT_0_MASK_ADDR A:0x1c0018c
y.create.l HWIO_OXILI_RBBM_INT_0_STATUS_ADDR A:0x1c00190
y.create.l HWIO_OXILI_RBBM_INT_1_MASK_CTL_ADDR A:0x1c00194
y.create.l HWIO_OXILI_RBBM_INT_1_STATUS_ADDR A:0x1c00198
y.create.l HWIO_OXILI_RBBM_INT_2_MASK_ADDR A:0x1c0019c
y.create.l HWIO_OXILI_RBBM_INT_2_STATUS_ADDR A:0x1c001a0
y.create.l HWIO_OXILI_RBBM_INT_3_MASK_ADDR A:0x1c001a4
y.create.l HWIO_OXILI_RBBM_INT_3_STATUS_ADDR A:0x1c001a8
y.create.l HWIO_OXILI_RBBM_INT_4_MASK_ADDR A:0x1c001ac
y.create.l HWIO_OXILI_RBBM_INT_4_STATUS_ADDR A:0x1c001b0
y.create.l HWIO_OXILI_RBBM_PERFCTR_CTL_ADDR A:0x1c00200
y.create.l HWIO_OXILI_RBBM_PERFCTR_LOAD_CMD0_ADDR A:0x1c00204
y.create.l HWIO_OXILI_RBBM_PERFCTR_LOAD_CMD1_ADDR A:0x1c00208
y.create.l HWIO_OXILI_RBBM_PERFCTR_LOAD_VALUE_LO_ADDR A:0x1c00210
y.create.l HWIO_OXILI_RBBM_PERFCTR_LOAD_VALUE_HI_ADDR A:0x1c00214
y.create.l HWIO_OXILI_RBBM_PERFCTR_RBBM_0_SEL_ADDR A:0x1c00218
y.create.l HWIO_OXILI_RBBM_PERFCTR_RBBM_1_SEL_ADDR A:0x1c0021c
y.create.l HWIO_OXILI_RBBM_GPU_BUSY_MAKSED_ADDR A:0x1c00220
y.create.l HWIO_OXILI_RBBM_PERFCTR_CP_0_LO_ADDR A:0x1c00240
y.create.l HWIO_OXILI_RBBM_PERFCTR_CP_0_HI_ADDR A:0x1c00244
y.create.l HWIO_OXILI_RBBM_PERFCTR_RBBM_0_LO_ADDR A:0x1c00248
y.create.l HWIO_OXILI_RBBM_PERFCTR_RBBM_0_HI_ADDR A:0x1c0024c
y.create.l HWIO_OXILI_RBBM_PERFCTR_RBBM_1_LO_ADDR A:0x1c00250
y.create.l HWIO_OXILI_RBBM_PERFCTR_RBBM_1_HI_ADDR A:0x1c00254
y.create.l HWIO_OXILI_RBBM_PERFCTR_PC_0_LO_ADDR A:0x1c00258
y.create.l HWIO_OXILI_RBBM_PERFCTR_PC_0_HI_ADDR A:0x1c0025c
y.create.l HWIO_OXILI_RBBM_PERFCTR_PC_1_LO_ADDR A:0x1c00260
y.create.l HWIO_OXILI_RBBM_PERFCTR_PC_1_HI_ADDR A:0x1c00264
y.create.l HWIO_OXILI_RBBM_PERFCTR_PC_2_LO_ADDR A:0x1c00268
y.create.l HWIO_OXILI_RBBM_PERFCTR_PC_2_HI_ADDR A:0x1c0026c
y.create.l HWIO_OXILI_RBBM_PERFCTR_PC_3_LO_ADDR A:0x1c00270
y.create.l HWIO_OXILI_RBBM_PERFCTR_PC_3_HI_ADDR A:0x1c00274
y.create.l HWIO_OXILI_RBBM_PERFCTR_VFD_0_LO_ADDR A:0x1c00278
y.create.l HWIO_OXILI_RBBM_PERFCTR_VFD_0_HI_ADDR A:0x1c0027c
y.create.l HWIO_OXILI_RBBM_PERFCTR_VFD_1_LO_ADDR A:0x1c00280
y.create.l HWIO_OXILI_RBBM_PERFCTR_VFD_1_HI_ADDR A:0x1c00284
y.create.l HWIO_OXILI_RBBM_PERFCTR_HLSQ_0_LO_ADDR A:0x1c00288
y.create.l HWIO_OXILI_RBBM_PERFCTR_HLSQ_0_HI_ADDR A:0x1c0028c
y.create.l HWIO_OXILI_RBBM_PERFCTR_HLSQ_1_LO_ADDR A:0x1c00290
y.create.l HWIO_OXILI_RBBM_PERFCTR_HLSQ_1_HI_ADDR A:0x1c00294
y.create.l HWIO_OXILI_RBBM_PERFCTR_HLSQ_2_LO_ADDR A:0x1c00298
y.create.l HWIO_OXILI_RBBM_PERFCTR_HLSQ_2_HI_ADDR A:0x1c0029c
y.create.l HWIO_OXILI_RBBM_PERFCTR_HLSQ_3_LO_ADDR A:0x1c002a0
y.create.l HWIO_OXILI_RBBM_PERFCTR_HLSQ_3_HI_ADDR A:0x1c002a4
y.create.l HWIO_OXILI_RBBM_PERFCTR_HLSQ_4_LO_ADDR A:0x1c002a8
y.create.l HWIO_OXILI_RBBM_PERFCTR_HLSQ_4_HI_ADDR A:0x1c002ac
y.create.l HWIO_OXILI_RBBM_PERFCTR_HLSQ_5_LO_ADDR A:0x1c002b0
y.create.l HWIO_OXILI_RBBM_PERFCTR_HLSQ_5_HI_ADDR A:0x1c002b4
y.create.l HWIO_OXILI_RBBM_PERFCTR_VPC_0_LO_ADDR A:0x1c002b8
y.create.l HWIO_OXILI_RBBM_PERFCTR_VPC_0_HI_ADDR A:0x1c002bc
y.create.l HWIO_OXILI_RBBM_PERFCTR_VPC_1_LO_ADDR A:0x1c002c0
y.create.l HWIO_OXILI_RBBM_PERFCTR_VPC_1_HI_ADDR A:0x1c002c4
y.create.l HWIO_OXILI_RBBM_PERFCTR_TSE_0_LO_ADDR A:0x1c002c8
y.create.l HWIO_OXILI_RBBM_PERFCTR_TSE_0_HI_ADDR A:0x1c002cc
y.create.l HWIO_OXILI_RBBM_PERFCTR_TSE_1_LO_ADDR A:0x1c002d0
y.create.l HWIO_OXILI_RBBM_PERFCTR_TSE_1_HI_ADDR A:0x1c002d4
y.create.l HWIO_OXILI_RBBM_PERFCTR_RAS_0_LO_ADDR A:0x1c002d8
y.create.l HWIO_OXILI_RBBM_PERFCTR_RAS_0_HI_ADDR A:0x1c002dc
y.create.l HWIO_OXILI_RBBM_PERFCTR_RAS_1_LO_ADDR A:0x1c002e0
y.create.l HWIO_OXILI_RBBM_PERFCTR_RAS_1_HI_ADDR A:0x1c002e4
y.create.l HWIO_OXILI_RBBM_PERFCTR_UCHE_0_LO_ADDR A:0x1c002e8
y.create.l HWIO_OXILI_RBBM_PERFCTR_UCHE_0_HI_ADDR A:0x1c002ec
y.create.l HWIO_OXILI_RBBM_PERFCTR_UCHE_1_LO_ADDR A:0x1c002f0
y.create.l HWIO_OXILI_RBBM_PERFCTR_UCHE_1_HI_ADDR A:0x1c002f4
y.create.l HWIO_OXILI_RBBM_PERFCTR_UCHE_2_LO_ADDR A:0x1c002f8
y.create.l HWIO_OXILI_RBBM_PERFCTR_UCHE_2_HI_ADDR A:0x1c002fc
y.create.l HWIO_OXILI_RBBM_PERFCTR_UCHE_3_LO_ADDR A:0x1c00300
y.create.l HWIO_OXILI_RBBM_PERFCTR_UCHE_3_HI_ADDR A:0x1c00304
y.create.l HWIO_OXILI_RBBM_PERFCTR_UCHE_4_LO_ADDR A:0x1c00308
y.create.l HWIO_OXILI_RBBM_PERFCTR_UCHE_4_HI_ADDR A:0x1c0030c
y.create.l HWIO_OXILI_RBBM_PERFCTR_UCHE_5_LO_ADDR A:0x1c00310
y.create.l HWIO_OXILI_RBBM_PERFCTR_UCHE_5_HI_ADDR A:0x1c00314
y.create.l HWIO_OXILI_RBBM_PERFCTR_TP_0_LO_ADDR A:0x1c00318
y.create.l HWIO_OXILI_RBBM_PERFCTR_TP_0_HI_ADDR A:0x1c0031c
y.create.l HWIO_OXILI_RBBM_PERFCTR_TP_1_LO_ADDR A:0x1c00320
y.create.l HWIO_OXILI_RBBM_PERFCTR_TP_1_HI_ADDR A:0x1c00324
y.create.l HWIO_OXILI_RBBM_PERFCTR_TP_2_LO_ADDR A:0x1c00328
y.create.l HWIO_OXILI_RBBM_PERFCTR_TP_2_HI_ADDR A:0x1c0032c
y.create.l HWIO_OXILI_RBBM_PERFCTR_TP_3_LO_ADDR A:0x1c00330
y.create.l HWIO_OXILI_RBBM_PERFCTR_TP_3_HI_ADDR A:0x1c00334
y.create.l HWIO_OXILI_RBBM_PERFCTR_TP_4_LO_ADDR A:0x1c00338
y.create.l HWIO_OXILI_RBBM_PERFCTR_TP_4_HI_ADDR A:0x1c0033c
y.create.l HWIO_OXILI_RBBM_PERFCTR_TP_5_LO_ADDR A:0x1c00340
y.create.l HWIO_OXILI_RBBM_PERFCTR_TP_5_HI_ADDR A:0x1c00344
y.create.l HWIO_OXILI_RBBM_PERFCTR_SP_0_LO_ADDR A:0x1c00348
y.create.l HWIO_OXILI_RBBM_PERFCTR_SP_0_HI_ADDR A:0x1c0034c
y.create.l HWIO_OXILI_RBBM_PERFCTR_SP_1_LO_ADDR A:0x1c00350
y.create.l HWIO_OXILI_RBBM_PERFCTR_SP_1_HI_ADDR A:0x1c00354
y.create.l HWIO_OXILI_RBBM_PERFCTR_SP_2_LO_ADDR A:0x1c00358
y.create.l HWIO_OXILI_RBBM_PERFCTR_SP_2_HI_ADDR A:0x1c0035c
y.create.l HWIO_OXILI_RBBM_PERFCTR_SP_3_LO_ADDR A:0x1c00360
y.create.l HWIO_OXILI_RBBM_PERFCTR_SP_3_HI_ADDR A:0x1c00364
y.create.l HWIO_OXILI_RBBM_PERFCTR_SP_4_LO_ADDR A:0x1c00368
y.create.l HWIO_OXILI_RBBM_PERFCTR_SP_4_HI_ADDR A:0x1c0036c
y.create.l HWIO_OXILI_RBBM_PERFCTR_SP_5_LO_ADDR A:0x1c00370
y.create.l HWIO_OXILI_RBBM_PERFCTR_SP_5_HI_ADDR A:0x1c00374
y.create.l HWIO_OXILI_RBBM_PERFCTR_SP_6_LO_ADDR A:0x1c00378
y.create.l HWIO_OXILI_RBBM_PERFCTR_SP_6_HI_ADDR A:0x1c0037c
y.create.l HWIO_OXILI_RBBM_PERFCTR_SP_7_LO_ADDR A:0x1c00380
y.create.l HWIO_OXILI_RBBM_PERFCTR_SP_7_HI_ADDR A:0x1c00384
y.create.l HWIO_OXILI_RBBM_PERFCTR_RB_0_LO_ADDR A:0x1c00388
y.create.l HWIO_OXILI_RBBM_PERFCTR_RB_0_HI_ADDR A:0x1c0038c
y.create.l HWIO_OXILI_RBBM_PERFCTR_RB_1_LO_ADDR A:0x1c00390
y.create.l HWIO_OXILI_RBBM_PERFCTR_RB_1_HI_ADDR A:0x1c00394
y.create.l HWIO_OXILI_RBBM_RBBM_CTL_ADDR A:0x1c00400
y.create.l HWIO_OXILI_RBBM_PERFCTR_PWR_0_LO_ADDR A:0x1c003a8
y.create.l HWIO_OXILI_RBBM_PERFCTR_PWR_0_HI_ADDR A:0x1c003ac
y.create.l HWIO_OXILI_RBBM_PERFCTR_PWR_1_LO_ADDR A:0x1c003b0
y.create.l HWIO_OXILI_RBBM_PERFCTR_PWR_1_HI_ADDR A:0x1c003b4
y.create.l HWIO_OXILI_RBBM_AHB_DEBUG_CTL_ADDR A:0x1c00440
y.create.l HWIO_OXILI_RBBM_DEBUG_BUS_CTL_ADDR A:0x1c00444
y.create.l HWIO_OXILI_RBBM_DEBUG_BUS_DATA_STATUS_ADDR A:0x1c00448
y.create.l HWIO_OXILI_RBBM_DEBUG_BUS_EN_CTL0_ADDR A:0x1c0044c
y.create.l HWIO_OXILI_RBBM_DEBUG_BUS_EN_CTL1_ADDR A:0x1c00450
y.create.l HWIO_OXILI_RBBM_DEBUG_BUS_STB_CTL0_ADDR A:0x1c00454
y.create.l HWIO_OXILI_RBBM_DEBUG_BUS_STB_CTL1_ADDR A:0x1c00458
y.create.l HWIO_OXILI_RBBM_MISR_BUS_CTL_ADDR A:0x1c0045c
y.create.l HWIO_OXILI_RBBM_MISR_BUS_CNT_ADDR A:0x1c00460
y.create.l HWIO_OXILI_RBBM_MISR_SIG_LO_ADDR A:0x1c00464
y.create.l HWIO_OXILI_RBBM_MISR_SIG_HI_ADDR A:0x1c00468
y.create.l HWIO_OXILI_RBBM_MISR_BUS_STB_CTL0_ADDR A:0x1c0046c
y.create.l HWIO_OXILI_RBBM_MISR_BUS_STB_CTL1_ADDR A:0x1c00470
y.create.l HWIO_OXILI_RBBM_INT_TRACE_BUS_CTL_ADDR A:0x1c00474
y.create.l HWIO_OXILI_RBBM_EXT_TRACE_BUS_CTL_ADDR A:0x1c00478
y.create.l HWIO_OXILI_RBBM_EXT_TRACE_STOP_CNT_ADDR A:0x1c0047c
y.create.l HWIO_OXILI_RBBM_EXT_TRACE_START_CNT_ADDR A:0x1c00480
y.create.l HWIO_OXILI_RBBM_EXT_TRACE_PERIOD_CNT_ADDR A:0x1c00484
y.create.l HWIO_OXILI_RBBM_EXT_TRACE_CMD_ADDR A:0x1c00488
y.create.l HWIO_OXILI_RBBM_VBIF_DEBUG_CTL_ADDR A:0x1c0048c
y.create.l HWIO_OXILI_RBBM_VBIF_AXI_MN_HALTREQ_ADDR A:0x1c00490
y.create.l HWIO_OXILI_RBBM_VBIF_AXI_MN_HALTACK_ADDR A:0x1c00494
y.create.l HWIO_OXILI_CP_RB_BASE_ADDR A:0x1c00700
y.create.l HWIO_OXILI_CP_RB_CNTL_ADDR A:0x1c00704
y.create.l HWIO_OXILI_CP_RB_RPTR_ADDR_ADDR A:0x1c0070c
y.create.l HWIO_OXILI_CP_RB_RPTR_ADDR A:0x1c00710
y.create.l HWIO_OXILI_CP_RB_RPTR_WR_ADDR A:0x1c0071c
y.create.l HWIO_OXILI_CP_RB_WPTR_ADDR A:0x1c00714
y.create.l HWIO_OXILI_CP_IB1_BASE_ADDR A:0x1c01160
y.create.l HWIO_OXILI_CP_IB1_BUFSZ_ADDR A:0x1c01164
y.create.l HWIO_OXILI_CP_IB2_BASE_ADDR A:0x1c01168
y.create.l HWIO_OXILI_CP_IB2_BUFSZ_ADDR A:0x1c0116c
y.create.l HWIO_OXILI_CP_ST_BASE_ADDR A:0x1c01134
y.create.l HWIO_OXILI_CP_ST_BUFSZ_ADDR A:0x1c01138
y.create.l HWIO_OXILI_CP_QUEUE_THRESHOLDS_ADDR A:0x1c00754
y.create.l HWIO_OXILI_CP_MEQ_THRESHOLDS_ADDR A:0x1c00758
y.create.l HWIO_OXILI_CP_CSQ_AVAIL_ADDR A:0x1c0075c
y.create.l HWIO_OXILI_CP_STQ_AVAIL_ADDR A:0x1c00760
y.create.l HWIO_OXILI_CP_MEQ_AVAIL_ADDR A:0x1c00764
y.create.l HWIO_OXILI_CP_CSQ_RB_STAT_ADDR A:0x1c007f4
y.create.l HWIO_OXILI_CP_CSQ_IB1_STAT_ADDR A:0x1c007f8
y.create.l HWIO_OXILI_CP_CSQ_IB2_STAT_ADDR A:0x1c007fc
y.create.l HWIO_OXILI_CP_NON_PREFETCH_CNTRS_ADDR A:0x1c01100
y.create.l HWIO_OXILI_CP_STQ_ST_STAT_ADDR A:0x1c0110c
y.create.l HWIO_OXILI_CP_MEQ_STAT_ADDR A:0x1c0113c
y.create.l HWIO_OXILI_CP_MIU_TAG_STAT_ADDR A:0x1c01148
y.create.l HWIO_OXILI_CP_MEQ_ADDR_ADDR A:0x1c00768
y.create.l HWIO_OXILI_CP_MEQ_DATA_ADDR A:0x1c0076c
y.create.l HWIO_OXILI_CP_ROQ_ADDR_ADDR A:0x1c00730
y.create.l HWIO_OXILI_CP_ROQ_DATA_ADDR A:0x1c00734
y.create.l HWIO_OXILI_CP_WFI_PEND_CTR_ADDR A:0x1c007d4
y.create.l HWIO_OXILI_CP_ME_CNTL_ADDR A:0x1c007d8
y.create.l HWIO_OXILI_CP_ME_STATUS_ADDR A:0x1c007dc
y.create.l HWIO_OXILI_CP_ME_RAM_WADDR_ADDR A:0x1c007e0
y.create.l HWIO_OXILI_CP_ME_RAM_RADDR_ADDR A:0x1c007e4
y.create.l HWIO_OXILI_CP_ME_RAM_DATA_ADDR A:0x1c007e8
y.create.l HWIO_OXILI_CP_ME_RDADDR_ADDR A:0x1c007a8
y.create.l HWIO_OXILI_CP_DEBUG_ADDR A:0x1c007f0
y.create.l HWIO_OXILI_CP_ME_VS_EVENT_SRC_ADDR A:0x1c01800
y.create.l HWIO_OXILI_CP_ME_VS_EVENT_ADDR_ADDR A:0x1c01804
y.create.l HWIO_OXILI_CP_ME_VS_EVENT_DATA_ADDR A:0x1c01808
y.create.l HWIO_OXILI_CP_ME_PS_EVENT_SRC_ADDR A:0x1c01814
y.create.l HWIO_OXILI_CP_ME_PS_EVENT_ADDR_ADDR A:0x1c01818
y.create.l HWIO_OXILI_CP_ME_PS_EVENT_DATA_ADDR A:0x1c0181c
y.create.l HWIO_OXILI_CP_ME_CF_EVENT_SRC_ADDR A:0x1c01828
y.create.l HWIO_OXILI_CP_ME_CF_EVENT_ADDR_ADDR A:0x1c0182c
y.create.l HWIO_OXILI_CP_ME_CF_EVENT_DATA_ADDR A:0x1c01830
y.create.l HWIO_OXILI_CP_ME_NRT_ADDR_ADDR A:0x1c01834
y.create.l HWIO_OXILI_CP_ME_NRT_DATA_ADDR A:0x1c01838
y.create.l HWIO_OXILI_CP_ME_RB_DONE_SRC_ADDR A:0x1c01848
y.create.l HWIO_OXILI_CP_ME_RB_DONE_ADDR_ADDR A:0x1c0184c
y.create.l HWIO_OXILI_CP_ME_RB_DONE_DATA_ADDR A:0x1c01850
y.create.l HWIO_OXILI_CP_PFP_UCODE_ADDR_ADDR A:0x1c00724
y.create.l HWIO_OXILI_CP_PFP_UCODE_DATA_ADDR A:0x1c00728
y.create.l HWIO_OXILI_CP_PERFCOUNTER_SELECT_ADDR A:0x1c01114
y.create.l HWIO_OXILI_CP_BIN_MASK_LO_ADDR A:0x1c01150
y.create.l HWIO_OXILI_CP_BIN_MASK_HI_ADDR A:0x1c01154
y.create.l HWIO_OXILI_CP_BIN_SELECT_LO_ADDR A:0x1c01158
y.create.l HWIO_OXILI_CP_BIN_SELECT_HI_ADDR A:0x1c0115c
y.create.l HWIO_OXILI_CP_NV_FLAGS_0_ADDR A:0x1c007b8
y.create.l HWIO_OXILI_CP_NV_FLAGS_1_ADDR A:0x1c007bc
y.create.l HWIO_OXILI_CP_NV_FLAGS_2_ADDR A:0x1c007c0
y.create.l HWIO_OXILI_CP_NV_FLAGS_3_ADDR A:0x1c007c4
y.create.l HWIO_OXILI_CP_STATE_DEBUG_INDEX_ADDR A:0x1c007b0
y.create.l HWIO_OXILI_CP_STATE_DEBUG_DATA_ADDR A:0x1c007b4
y.create.l HWIO_OXILI_CP_STAT_ADDR A:0x1c011fc
y.create.l HWIO_OXILI_CP_ECO_CTRL_ADDR A:0x1c011f0
y.create.l HWIO_OXILI_CP_HW_FAULT_ADDR A:0x1c01170
y.create.l HWIO_OXILI_CP_AHB_FAULT_ADDR A:0x1c01174
y.create.l HWIO_OXILI_CP_PROTECT_CTRL_ADDR A:0x1c01178
y.create.l HWIO_OXILI_CP_PROTECT_STATUS_ADDR A:0x1c0117c
y.create.l HWIO_OXILI_CP_PROTECT_REG_0_ADDR A:0x1c01180
y.create.l HWIO_OXILI_CP_PROTECT_REG_1_ADDR A:0x1c01184
y.create.l HWIO_OXILI_CP_PROTECT_REG_2_ADDR A:0x1c01188
y.create.l HWIO_OXILI_CP_PROTECT_REG_3_ADDR A:0x1c0118c
y.create.l HWIO_OXILI_CP_PROTECT_REG_4_ADDR A:0x1c01190
y.create.l HWIO_OXILI_CP_PROTECT_REG_5_ADDR A:0x1c01194
y.create.l HWIO_OXILI_CP_PROTECT_REG_6_ADDR A:0x1c01198
y.create.l HWIO_OXILI_CP_PROTECT_REG_7_ADDR A:0x1c0119c
y.create.l HWIO_OXILI_CP_PROTECT_REG_8_ADDR A:0x1c011a0
y.create.l HWIO_OXILI_CP_PROTECT_REG_9_ADDR A:0x1c011a4
y.create.l HWIO_OXILI_CP_PROTECT_REG_A_ADDR A:0x1c011a8
y.create.l HWIO_OXILI_CP_PROTECT_REG_B_ADDR A:0x1c011ac
y.create.l HWIO_OXILI_CP_PROTECT_REG_C_ADDR A:0x1c011b0
y.create.l HWIO_OXILI_CP_PROTECT_REG_D_ADDR A:0x1c011b4
y.create.l HWIO_OXILI_CP_PROTECT_REG_E_ADDR A:0x1c011b8
y.create.l HWIO_OXILI_CP_PROTECT_REG_F_ADDR A:0x1c011bc
y.create.l HWIO_OXILI_CP_SCRATCH_UMASK_ADDR A:0x1c00770
y.create.l HWIO_OXILI_CP_SCRATCH_ADDR_ADDR A:0x1c00774
y.create.l HWIO_OXILI_CP_SCRATCH_REG0_ADDR A:0x1c015e0
y.create.l HWIO_OXILI_CP_SCRATCH_REG1_ADDR A:0x1c015e4
y.create.l HWIO_OXILI_CP_SCRATCH_REG2_ADDR A:0x1c015e8
y.create.l HWIO_OXILI_CP_SCRATCH_REG3_ADDR A:0x1c015ec
y.create.l HWIO_OXILI_CP_SCRATCH_REG4_ADDR A:0x1c015f0
y.create.l HWIO_OXILI_CP_SCRATCH_REG5_ADDR A:0x1c015f4
y.create.l HWIO_OXILI_CP_SCRATCH_REG6_ADDR A:0x1c015f8
y.create.l HWIO_OXILI_CP_SCRATCH_REG7_ADDR A:0x1c015fc
y.create.l HWIO_OXILI_PC_BINNING_ENABLE_ADDR A:0x1c030f0
y.create.l HWIO_OXILI_PC_PC_DRAWCALL_VIZ_CONTROL_ADDR A:0x1c030f4
y.create.l HWIO_OXILI_PC_PC_DEBUG_PRIM_STEP_CONTROL_ADDR A:0x1c030f8
y.create.l HWIO_OXILI_PC_PC_DEBUG_REG_ADDR A:0x1c030fc
y.create.l HWIO_OXILI_PC_PERFCOUNTER0_SELECT_ADDR A:0x1c03120
y.create.l HWIO_OXILI_PC_PERFCOUNTER1_SELECT_ADDR A:0x1c03124
y.create.l HWIO_OXILI_PC_PERFCOUNTER2_SELECT_ADDR A:0x1c03128
y.create.l HWIO_OXILI_PC_PERFCOUNTER3_SELECT_ADDR A:0x1c0312c
y.create.l HWIO_OXILI_PC_BIN_BASE_CTX_0_ADDR A:0x1c08784
y.create.l HWIO_OXILI_PC_BIN_SIZE_CTX_0_ADDR A:0x1c08788
y.create.l HWIO_OXILI_PC_DMA_BASE_CTX_0_ADDR A:0x1c087e8
y.create.l HWIO_OXILI_PC_DMA_SIZE_CTX_0_ADDR A:0x1c087ec
y.create.l HWIO_OXILI_PC_DRAW_INITIATOR_CTX_0_ADDR A:0x1c087f0
y.create.l HWIO_OXILI_PC_VSTREAM_CONTROL_CTX_0_ADDR A:0x1c08790
y.create.l HWIO_OXILI_PC_EVENT_INITIATOR_CTX_0_ADDR A:0x1c087e4
y.create.l HWIO_OXILI_PC_IMMED_DATA_CTX_0_ADDR A:0x1c087f4
y.create.l HWIO_OXILI_PC_PRE_DRAW_INITIATOR_CTX_0_ADDR A:0x1c087f8
y.create.l HWIO_OXILI_PC_PRE_DRAW_INITIATOR_SIZE_CTX_0_ADDR A:0x1c087fc
y.create.l HWIO_OXILI_PC_VERTEX_REUSE_BLOCK_CNTL_CTX_0_ADDR A:0x1c087a8
y.create.l HWIO_OXILI_PC_PRIM_VTX_CNTL_CTX_0_ADDR A:0x1c087b0
y.create.l HWIO_OXILI_PC_RESTART_INDEX_CTX_0_ADDR A:0x1c087b4
y.create.l HWIO_OXILI_PC_CL_EXE_INITIATOR_CTX_0_ADDR A:0x1c087c0
y.create.l HWIO_OXILI_PC_BIN_BASE_CTX_1_ADDR A:0x1c09784
y.create.l HWIO_OXILI_PC_BIN_SIZE_CTX_1_ADDR A:0x1c09788
y.create.l HWIO_OXILI_PC_DMA_BASE_CTX_1_ADDR A:0x1c097e8
y.create.l HWIO_OXILI_PC_DMA_SIZE_CTX_1_ADDR A:0x1c097ec
y.create.l HWIO_OXILI_PC_DRAW_INITIATOR_CTX_1_ADDR A:0x1c097f0
y.create.l HWIO_OXILI_PC_VSTREAM_CONTROL_CTX_1_ADDR A:0x1c09790
y.create.l HWIO_OXILI_PC_EVENT_INITIATOR_CTX_1_ADDR A:0x1c097e4
y.create.l HWIO_OXILI_PC_IMMED_DATA_CTX_1_ADDR A:0x1c097f4
y.create.l HWIO_OXILI_PC_PRE_DRAW_INITIATOR_CTX_1_ADDR A:0x1c097f8
y.create.l HWIO_OXILI_PC_PRE_DRAW_INITIATOR_SIZE_CTX_1_ADDR A:0x1c097fc
y.create.l HWIO_OXILI_PC_VERTEX_REUSE_BLOCK_CNTL_CTX_1_ADDR A:0x1c097a8
y.create.l HWIO_OXILI_PC_PRIM_VTX_CNTL_CTX_1_ADDR A:0x1c097b0
y.create.l HWIO_OXILI_PC_RESTART_INDEX_CTX_1_ADDR A:0x1c097b4
y.create.l HWIO_OXILI_PC_CL_EXE_INITIATOR_CTX_1_ADDR A:0x1c097c0
y.create.l HWIO_OXILI_GRAS_CL_USER_PLANE_X0_ADDR A:0x1c03280
y.create.l HWIO_OXILI_GRAS_CL_USER_PLANE_Y0_ADDR A:0x1c03284
y.create.l HWIO_OXILI_GRAS_CL_USER_PLANE_Z0_ADDR A:0x1c03288
y.create.l HWIO_OXILI_GRAS_CL_USER_PLANE_W0_ADDR A:0x1c0328c
y.create.l HWIO_OXILI_GRAS_CL_USER_PLANE_X1_ADDR A:0x1c03290
y.create.l HWIO_OXILI_GRAS_CL_USER_PLANE_Y1_ADDR A:0x1c03294
y.create.l HWIO_OXILI_GRAS_CL_USER_PLANE_Z1_ADDR A:0x1c03298
y.create.l HWIO_OXILI_GRAS_CL_USER_PLANE_W1_ADDR A:0x1c0329c
y.create.l HWIO_OXILI_GRAS_CL_USER_PLANE_X2_ADDR A:0x1c032a0
y.create.l HWIO_OXILI_GRAS_CL_USER_PLANE_Y2_ADDR A:0x1c032a4
y.create.l HWIO_OXILI_GRAS_CL_USER_PLANE_Z2_ADDR A:0x1c032a8
y.create.l HWIO_OXILI_GRAS_CL_USER_PLANE_W2_ADDR A:0x1c032ac
y.create.l HWIO_OXILI_GRAS_CL_USER_PLANE_X3_ADDR A:0x1c032b0
y.create.l HWIO_OXILI_GRAS_CL_USER_PLANE_Y3_ADDR A:0x1c032b4
y.create.l HWIO_OXILI_GRAS_CL_USER_PLANE_Z3_ADDR A:0x1c032b8
y.create.l HWIO_OXILI_GRAS_CL_USER_PLANE_W3_ADDR A:0x1c032bc
y.create.l HWIO_OXILI_GRAS_CL_USER_PLANE_X4_ADDR A:0x1c032c0
y.create.l HWIO_OXILI_GRAS_CL_USER_PLANE_Y4_ADDR A:0x1c032c4
y.create.l HWIO_OXILI_GRAS_CL_USER_PLANE_Z4_ADDR A:0x1c032c8
y.create.l HWIO_OXILI_GRAS_CL_USER_PLANE_W4_ADDR A:0x1c032cc
y.create.l HWIO_OXILI_GRAS_CL_USER_PLANE_X5_ADDR A:0x1c032d0
y.create.l HWIO_OXILI_GRAS_CL_USER_PLANE_Y5_ADDR A:0x1c032d4
y.create.l HWIO_OXILI_GRAS_CL_USER_PLANE_Z5_ADDR A:0x1c032d8
y.create.l HWIO_OXILI_GRAS_CL_USER_PLANE_W5_ADDR A:0x1c032dc
y.create.l HWIO_OXILI_GRAS_TSE_STATUS_ADDR A:0x1c03200
y.create.l HWIO_OXILI_GRAS_TSE_DEBUG_ECO_ADDR A:0x1c03204
y.create.l HWIO_OXILI_GRAS_SU_PERFCOUNTER0_SELECT_ADDR A:0x1c03220
y.create.l HWIO_OXILI_GRAS_SU_PERFCOUNTER1_SELECT_ADDR A:0x1c03224
y.create.l HWIO_OXILI_GRAS_SU_PERFCOUNTER2_SELECT_ADDR A:0x1c03228
y.create.l HWIO_OXILI_GRAS_SU_PERFCOUNTER3_SELECT_ADDR A:0x1c0322c
y.create.l HWIO_OXILI_GRAS_CL_CLIP_CNTL_CTX_0_ADDR A:0x1c08100
y.create.l HWIO_OXILI_GRAS_CL_GB_CLIP_ADJ_CTX_0_ADDR A:0x1c08110
y.create.l HWIO_OXILI_GRAS_CL_VPORT_XOFFSET_CTX_0_ADDR A:0x1c08120
y.create.l HWIO_OXILI_GRAS_CL_VPORT_XSCALE_CTX_0_ADDR A:0x1c08124
y.create.l HWIO_OXILI_GRAS_CL_VPORT_YOFFSET_CTX_0_ADDR A:0x1c08128
y.create.l HWIO_OXILI_GRAS_CL_VPORT_YSCALE_CTX_0_ADDR A:0x1c0812c
y.create.l HWIO_OXILI_GRAS_CL_VPORT_ZOFFSET_CTX_0_ADDR A:0x1c08130
y.create.l HWIO_OXILI_GRAS_CL_VPORT_ZSCALE_CTX_0_ADDR A:0x1c08134
y.create.l HWIO_OXILI_GRAS_SU_POINT_MINMAX_CTX_0_ADDR A:0x1c081a0
y.create.l HWIO_OXILI_GRAS_SU_POINT_SIZE_CTX_0_ADDR A:0x1c081a4
y.create.l HWIO_OXILI_GRAS_SU_POLY_OFFSET_OFFSET_CTX_0_ADDR A:0x1c081b4
y.create.l HWIO_OXILI_GRAS_SU_POLY_OFFSET_SCALE_CTX_0_ADDR A:0x1c081b0
y.create.l HWIO_OXILI_GRAS_SU_MODE_CONTROL_CTX_0_ADDR A:0x1c081c0
y.create.l HWIO_OXILI_GRAS_SC_CONTROL_CTX_0_ADDR A:0x1c081c8
y.create.l HWIO_OXILI_GRAS_SC_SCREEN_SCISSOR_TL_CTX_0_ADDR A:0x1c081d0
y.create.l HWIO_OXILI_GRAS_SC_SCREEN_SCISSOR_BR_CTX_0_ADDR A:0x1c081d4
y.create.l HWIO_OXILI_GRAS_SC_WINDOW_SCISSOR_BR_CTX_0_ADDR A:0x1c081e8
y.create.l HWIO_OXILI_GRAS_SC_WINDOW_SCISSOR_TL_CTX_0_ADDR A:0x1c081e4
y.create.l HWIO_OXILI_GRAS_CL_CLIP_CNTL_CTX_1_ADDR A:0x1c09100
y.create.l HWIO_OXILI_GRAS_CL_GB_CLIP_ADJ_CTX_1_ADDR A:0x1c09110
y.create.l HWIO_OXILI_GRAS_CL_VPORT_XOFFSET_CTX_1_ADDR A:0x1c09120
y.create.l HWIO_OXILI_GRAS_CL_VPORT_XSCALE_CTX_1_ADDR A:0x1c09124
y.create.l HWIO_OXILI_GRAS_CL_VPORT_YOFFSET_CTX_1_ADDR A:0x1c09128
y.create.l HWIO_OXILI_GRAS_CL_VPORT_YSCALE_CTX_1_ADDR A:0x1c0912c
y.create.l HWIO_OXILI_GRAS_CL_VPORT_ZOFFSET_CTX_1_ADDR A:0x1c09130
y.create.l HWIO_OXILI_GRAS_CL_VPORT_ZSCALE_CTX_1_ADDR A:0x1c09134
y.create.l HWIO_OXILI_GRAS_SU_POINT_MINMAX_CTX_1_ADDR A:0x1c091a0
y.create.l HWIO_OXILI_GRAS_SU_POINT_SIZE_CTX_1_ADDR A:0x1c091a4
y.create.l HWIO_OXILI_GRAS_SU_POLY_OFFSET_OFFSET_CTX_1_ADDR A:0x1c091b4
y.create.l HWIO_OXILI_GRAS_SU_POLY_OFFSET_SCALE_CTX_1_ADDR A:0x1c091b0
y.create.l HWIO_OXILI_GRAS_SU_MODE_CONTROL_CTX_1_ADDR A:0x1c091c0
y.create.l HWIO_OXILI_GRAS_SC_CONTROL_CTX_1_ADDR A:0x1c091c8
y.create.l HWIO_OXILI_GRAS_SC_SCREEN_SCISSOR_TL_CTX_1_ADDR A:0x1c091d0
y.create.l HWIO_OXILI_GRAS_SC_SCREEN_SCISSOR_BR_CTX_1_ADDR A:0x1c091d4
y.create.l HWIO_OXILI_GRAS_SC_WINDOW_SCISSOR_BR_CTX_1_ADDR A:0x1c091e8
y.create.l HWIO_OXILI_GRAS_SC_WINDOW_SCISSOR_TL_CTX_1_ADDR A:0x1c091e4
y.create.l HWIO_OXILI_HLSQ_PERFCOUNTER0_SELECT_REG_ADDR A:0x1c03800
y.create.l HWIO_OXILI_HLSQ_PERFCOUNTER1_SELECT_REG_ADDR A:0x1c03804
y.create.l HWIO_OXILI_HLSQ_PERFCOUNTER2_SELECT_REG_ADDR A:0x1c03808
y.create.l HWIO_OXILI_HLSQ_PERFCOUNTER3_SELECT_REG_ADDR A:0x1c0380c
y.create.l HWIO_OXILI_HLSQ_PERFCOUNTER4_SELECT_REG_ADDR A:0x1c03810
y.create.l HWIO_OXILI_HLSQ_PERFCOUNTER5_SELECT_REG_ADDR A:0x1c03814
y.create.l HWIO_OXILI_HLSQ_GLOBAL_MEM_LENGTH_REG_ADDR A:0x1c03888
y.create.l HWIO_OXILI_HLSQ_GLOBAL_MEM_ADDRESS_REG_ADDR A:0x1c0388c
y.create.l HWIO_OXILI_HLSQ_HLSQ_TIMEOUT_THRESHOLD_ADDR A:0x1c03830
y.create.l HWIO_OXILI_HLSQ_HLSQ_STAR_RDSEL_ADDR A:0x1c03884
y.create.l HWIO_OXILI_HLSQ_CONTROL_0_REG_CTX_0_ADDR A:0x1c08800
y.create.l HWIO_OXILI_HLSQ_CONTROL_1_REG_CTX_0_ADDR A:0x1c08804
y.create.l HWIO_OXILI_HLSQ_CONTROL_2_REG_CTX_0_ADDR A:0x1c08808
y.create.l HWIO_OXILI_HLSQ_CONTROL_3_REG_CTX_0_ADDR A:0x1c0880c
y.create.l HWIO_OXILI_HLSQ_VS_CONTROL_REG_CTX_0_ADDR A:0x1c08810
y.create.l HWIO_OXILI_HLSQ_FS_CONTROL_REG_CTX_0_ADDR A:0x1c08814
y.create.l HWIO_OXILI_HLSQ_CONST_VSPRESV_RANGE_REG_CTX_0_ADDR A:0x1c08818
y.create.l HWIO_OXILI_HLSQ_CONST_FSPRESV_RANGE_REG_CTX_0_ADDR A:0x1c0881c
y.create.l HWIO_OXILI_HLSQ_LOAD_CMD_0_REG_CTX_0_ADDR A:0x1c08820
y.create.l HWIO_OXILI_HLSQ_LOAD_CMD_1_REG_CTX_0_ADDR A:0x1c08824
y.create.l HWIO_OXILI_HLSQ_CL_NDRANGE_0_REG_CTX_0_ADDR A:0x1c08828
y.create.l HWIO_OXILI_HLSQ_CL_NDRANGE_1_REG_CTX_0_ADDR A:0x1c0882c
y.create.l HWIO_OXILI_HLSQ_CL_NDRANGE_2_REG_CTX_0_ADDR A:0x1c08830
y.create.l HWIO_OXILI_HLSQ_CL_NDRANGE_3_REG_CTX_0_ADDR A:0x1c08834
y.create.l HWIO_OXILI_HLSQ_CL_NDRANGE_4_REG_CTX_0_ADDR A:0x1c08838
y.create.l HWIO_OXILI_HLSQ_CL_NDRANGE_5_REG_CTX_0_ADDR A:0x1c0883c
y.create.l HWIO_OXILI_HLSQ_CL_NDRANGE_6_REG_CTX_0_ADDR A:0x1c08840
y.create.l HWIO_OXILI_HLSQ_CL_CONTROL_0_REG_CTX_0_ADDR A:0x1c08844
y.create.l HWIO_OXILI_HLSQ_CL_CONTROL_1_REG_CTX_0_ADDR A:0x1c08848
y.create.l HWIO_OXILI_HLSQ_CL_KERNEL_CONST_REG_CTX_0_ADDR A:0x1c08850
y.create.l HWIO_OXILI_HLSQ_CL_KERNEL_GROUP_X_REG_CTX_0_ADDR A:0x1c08854
y.create.l HWIO_OXILI_HLSQ_CL_KERNEL_GROUP_Y_REG_CTX_0_ADDR A:0x1c08858
y.create.l HWIO_OXILI_HLSQ_CL_KERNEL_GROUP_Z_REG_CTX_0_ADDR A:0x1c0885c
y.create.l HWIO_OXILI_HLSQ_CL_WG_OFFSET_REG_CTX_0_ADDR A:0x1c08868
y.create.l HWIO_OXILI_HLSQ_CONTROL_0_REG_CTX_1_ADDR A:0x1c09800
y.create.l HWIO_OXILI_HLSQ_CONTROL_1_REG_CTX_1_ADDR A:0x1c09804
y.create.l HWIO_OXILI_HLSQ_CONTROL_2_REG_CTX_1_ADDR A:0x1c09808
y.create.l HWIO_OXILI_HLSQ_CONTROL_3_REG_CTX_1_ADDR A:0x1c0980c
y.create.l HWIO_OXILI_HLSQ_VS_CONTROL_REG_CTX_1_ADDR A:0x1c09810
y.create.l HWIO_OXILI_HLSQ_FS_CONTROL_REG_CTX_1_ADDR A:0x1c09814
y.create.l HWIO_OXILI_HLSQ_CONST_VSPRESV_RANGE_REG_CTX_1_ADDR A:0x1c09818
y.create.l HWIO_OXILI_HLSQ_CONST_FSPRESV_RANGE_REG_CTX_1_ADDR A:0x1c0981c
y.create.l HWIO_OXILI_HLSQ_LOAD_CMD_0_REG_CTX_1_ADDR A:0x1c09820
y.create.l HWIO_OXILI_HLSQ_LOAD_CMD_1_REG_CTX_1_ADDR A:0x1c09824
y.create.l HWIO_OXILI_HLSQ_CL_NDRANGE_0_REG_CTX_1_ADDR A:0x1c09828
y.create.l HWIO_OXILI_HLSQ_CL_NDRANGE_1_REG_CTX_1_ADDR A:0x1c0982c
y.create.l HWIO_OXILI_HLSQ_CL_NDRANGE_2_REG_CTX_1_ADDR A:0x1c09830
y.create.l HWIO_OXILI_HLSQ_CL_NDRANGE_3_REG_CTX_1_ADDR A:0x1c09834
y.create.l HWIO_OXILI_HLSQ_CL_NDRANGE_4_REG_CTX_1_ADDR A:0x1c09838
y.create.l HWIO_OXILI_HLSQ_CL_NDRANGE_5_REG_CTX_1_ADDR A:0x1c0983c
y.create.l HWIO_OXILI_HLSQ_CL_NDRANGE_6_REG_CTX_1_ADDR A:0x1c09840
y.create.l HWIO_OXILI_HLSQ_CL_CONTROL_0_REG_CTX_1_ADDR A:0x1c09844
y.create.l HWIO_OXILI_HLSQ_CL_CONTROL_1_REG_CTX_1_ADDR A:0x1c09848
y.create.l HWIO_OXILI_HLSQ_CL_KERNEL_CONST_REG_CTX_1_ADDR A:0x1c09850
y.create.l HWIO_OXILI_HLSQ_CL_KERNEL_GROUP_X_REG_CTX_1_ADDR A:0x1c09854
y.create.l HWIO_OXILI_HLSQ_CL_KERNEL_GROUP_Y_REG_CTX_1_ADDR A:0x1c09858
y.create.l HWIO_OXILI_HLSQ_CL_KERNEL_GROUP_Z_REG_CTX_1_ADDR A:0x1c0985c
y.create.l HWIO_OXILI_HLSQ_CL_WG_OFFSET_REG_CTX_1_ADDR A:0x1c09868
y.create.l HWIO_OXILI_VFD_MODE_CONTROL_ADDR A:0x1c0390c
y.create.l HWIO_OXILI_VFD_STATUS_ADDR A:0x1c03908
y.create.l HWIO_OXILI_VFD_VFD_DEBUG_CONTROL_ADDR A:0x1c03904
y.create.l HWIO_OXILI_VFD_PERFCOUNTER0_SELECT_ADDR A:0x1c03910
y.create.l HWIO_OXILI_VFD_PERFCOUNTER1_SELECT_ADDR A:0x1c03914
y.create.l HWIO_OXILI_VFD_CONTROL_0_CTX_0_ADDR A:0x1c08900
y.create.l HWIO_OXILI_VFD_CONTROL_1_CTX_0_ADDR A:0x1c08904
y.create.l HWIO_OXILI_VFD_INDEX_MIN_CTX_0_ADDR A:0x1c08908
y.create.l HWIO_OXILI_VFD_INDEX_MAX_CTX_0_ADDR A:0x1c0890c
y.create.l HWIO_OXILI_VFD_INSTANCEID_OFFSET_CTX_0_ADDR A:0x1c08910
y.create.l HWIO_OXILI_VFD_INDEX_OFFSET_CTX_0_ADDR A:0x1c08914
y.create.l HWIO_OXILI_VFD_FETCH_INSTR_0_0_CTX_0_ADDR A:0x1c08918
y.create.l HWIO_OXILI_VFD_FETCH_INSTR_1_0_CTX_0_ADDR A:0x1c0891c
y.create.l HWIO_OXILI_VFD_FETCH_INSTR_0_1_CTX_0_ADDR A:0x1c08920
y.create.l HWIO_OXILI_VFD_FETCH_INSTR_1_1_CTX_0_ADDR A:0x1c08924
y.create.l HWIO_OXILI_VFD_FETCH_INSTR_0_2_CTX_0_ADDR A:0x1c08928
y.create.l HWIO_OXILI_VFD_FETCH_INSTR_1_2_CTX_0_ADDR A:0x1c0892c
y.create.l HWIO_OXILI_VFD_FETCH_INSTR_0_3_CTX_0_ADDR A:0x1c08930
y.create.l HWIO_OXILI_VFD_FETCH_INSTR_1_3_CTX_0_ADDR A:0x1c08934
y.create.l HWIO_OXILI_VFD_FETCH_INSTR_0_4_CTX_0_ADDR A:0x1c08938
y.create.l HWIO_OXILI_VFD_FETCH_INSTR_1_4_CTX_0_ADDR A:0x1c0893c
y.create.l HWIO_OXILI_VFD_FETCH_INSTR_0_5_CTX_0_ADDR A:0x1c08940
y.create.l HWIO_OXILI_VFD_FETCH_INSTR_1_5_CTX_0_ADDR A:0x1c08944
y.create.l HWIO_OXILI_VFD_FETCH_INSTR_0_6_CTX_0_ADDR A:0x1c08948
y.create.l HWIO_OXILI_VFD_FETCH_INSTR_1_6_CTX_0_ADDR A:0x1c0894c
y.create.l HWIO_OXILI_VFD_FETCH_INSTR_0_7_CTX_0_ADDR A:0x1c08950
y.create.l HWIO_OXILI_VFD_FETCH_INSTR_1_7_CTX_0_ADDR A:0x1c08954
y.create.l HWIO_OXILI_VFD_FETCH_INSTR_0_8_CTX_0_ADDR A:0x1c08958
y.create.l HWIO_OXILI_VFD_FETCH_INSTR_1_8_CTX_0_ADDR A:0x1c0895c
y.create.l HWIO_OXILI_VFD_FETCH_INSTR_0_9_CTX_0_ADDR A:0x1c08960
y.create.l HWIO_OXILI_VFD_FETCH_INSTR_1_9_CTX_0_ADDR A:0x1c08964
y.create.l HWIO_OXILI_VFD_FETCH_INSTR_0_A_CTX_0_ADDR A:0x1c08968
y.create.l HWIO_OXILI_VFD_FETCH_INSTR_1_A_CTX_0_ADDR A:0x1c0896c
y.create.l HWIO_OXILI_VFD_FETCH_INSTR_0_B_CTX_0_ADDR A:0x1c08970
y.create.l HWIO_OXILI_VFD_FETCH_INSTR_1_B_CTX_0_ADDR A:0x1c08974
y.create.l HWIO_OXILI_VFD_FETCH_INSTR_0_C_CTX_0_ADDR A:0x1c08978
y.create.l HWIO_OXILI_VFD_FETCH_INSTR_1_C_CTX_0_ADDR A:0x1c0897c
y.create.l HWIO_OXILI_VFD_FETCH_INSTR_0_D_CTX_0_ADDR A:0x1c08980
y.create.l HWIO_OXILI_VFD_FETCH_INSTR_1_D_CTX_0_ADDR A:0x1c08984
y.create.l HWIO_OXILI_VFD_FETCH_INSTR_0_E_CTX_0_ADDR A:0x1c08988
y.create.l HWIO_OXILI_VFD_FETCH_INSTR_1_E_CTX_0_ADDR A:0x1c0898c
y.create.l HWIO_OXILI_VFD_FETCH_INSTR_0_F_CTX_0_ADDR A:0x1c08990
y.create.l HWIO_OXILI_VFD_FETCH_INSTR_1_F_CTX_0_ADDR A:0x1c08994
y.create.l HWIO_OXILI_VFD_DECODE_INSTR_0_CTX_0_ADDR A:0x1c08998
y.create.l HWIO_OXILI_VFD_DECODE_INSTR_1_CTX_0_ADDR A:0x1c0899c
y.create.l HWIO_OXILI_VFD_DECODE_INSTR_2_CTX_0_ADDR A:0x1c089a0
y.create.l HWIO_OXILI_VFD_DECODE_INSTR_3_CTX_0_ADDR A:0x1c089a4
y.create.l HWIO_OXILI_VFD_DECODE_INSTR_4_CTX_0_ADDR A:0x1c089a8
y.create.l HWIO_OXILI_VFD_DECODE_INSTR_5_CTX_0_ADDR A:0x1c089ac
y.create.l HWIO_OXILI_VFD_DECODE_INSTR_6_CTX_0_ADDR A:0x1c089b0
y.create.l HWIO_OXILI_VFD_DECODE_INSTR_7_CTX_0_ADDR A:0x1c089b4
y.create.l HWIO_OXILI_VFD_DECODE_INSTR_8_CTX_0_ADDR A:0x1c089b8
y.create.l HWIO_OXILI_VFD_DECODE_INSTR_9_CTX_0_ADDR A:0x1c089bc
y.create.l HWIO_OXILI_VFD_DECODE_INSTR_10_CTX_0_ADDR A:0x1c089c0
y.create.l HWIO_OXILI_VFD_DECODE_INSTR_11_CTX_0_ADDR A:0x1c089c4
y.create.l HWIO_OXILI_VFD_DECODE_INSTR_12_CTX_0_ADDR A:0x1c089c8
y.create.l HWIO_OXILI_VFD_DECODE_INSTR_13_CTX_0_ADDR A:0x1c089cc
y.create.l HWIO_OXILI_VFD_DECODE_INSTR_14_CTX_0_ADDR A:0x1c089d0
y.create.l HWIO_OXILI_VFD_DECODE_INSTR_15_CTX_0_ADDR A:0x1c089d4
y.create.l HWIO_OXILI_VFD_DECODE_INSTR_16_CTX_0_ADDR A:0x1c089d8
y.create.l HWIO_OXILI_VFD_DECODE_INSTR_17_CTX_0_ADDR A:0x1c089dc
y.create.l HWIO_OXILI_VFD_DECODE_INSTR_18_CTX_0_ADDR A:0x1c089e0
y.create.l HWIO_OXILI_VFD_DECODE_INSTR_19_CTX_0_ADDR A:0x1c089e4
y.create.l HWIO_OXILI_VFD_DECODE_INSTR_20_CTX_0_ADDR A:0x1c089e8
y.create.l HWIO_OXILI_VFD_DECODE_INSTR_21_CTX_0_ADDR A:0x1c089ec
y.create.l HWIO_OXILI_VFD_DECODE_INSTR_22_CTX_0_ADDR A:0x1c089f0
y.create.l HWIO_OXILI_VFD_DECODE_INSTR_23_CTX_0_ADDR A:0x1c089f4
y.create.l HWIO_OXILI_VFD_VS_THREADING_THRESHOLD_CTX_0_ADDR A:0x1c089f8
y.create.l HWIO_OXILI_VFD_CONTROL_0_CTX_1_ADDR A:0x1c09900
y.create.l HWIO_OXILI_VFD_CONTROL_1_CTX_1_ADDR A:0x1c09904
y.create.l HWIO_OXILI_VFD_INDEX_MIN_CTX_1_ADDR A:0x1c09908
y.create.l HWIO_OXILI_VFD_INDEX_MAX_CTX_1_ADDR A:0x1c0990c
y.create.l HWIO_OXILI_VFD_INSTANCEID_OFFSET_CTX_1_ADDR A:0x1c09910
y.create.l HWIO_OXILI_VFD_INDEX_OFFSET_CTX_1_ADDR A:0x1c09914
y.create.l HWIO_OXILI_VFD_FETCH_INSTR_0_0_CTX_1_ADDR A:0x1c09918
y.create.l HWIO_OXILI_VFD_FETCH_INSTR_1_0_CTX_1_ADDR A:0x1c0991c
y.create.l HWIO_OXILI_VFD_FETCH_INSTR_0_1_CTX_1_ADDR A:0x1c09920
y.create.l HWIO_OXILI_VFD_FETCH_INSTR_1_1_CTX_1_ADDR A:0x1c09924
y.create.l HWIO_OXILI_VFD_FETCH_INSTR_0_2_CTX_1_ADDR A:0x1c09928
y.create.l HWIO_OXILI_VFD_FETCH_INSTR_1_2_CTX_1_ADDR A:0x1c0992c
y.create.l HWIO_OXILI_VFD_FETCH_INSTR_0_3_CTX_1_ADDR A:0x1c09930
y.create.l HWIO_OXILI_VFD_FETCH_INSTR_1_3_CTX_1_ADDR A:0x1c09934
y.create.l HWIO_OXILI_VFD_FETCH_INSTR_0_4_CTX_1_ADDR A:0x1c09938
y.create.l HWIO_OXILI_VFD_FETCH_INSTR_1_4_CTX_1_ADDR A:0x1c0993c
y.create.l HWIO_OXILI_VFD_FETCH_INSTR_0_5_CTX_1_ADDR A:0x1c09940
y.create.l HWIO_OXILI_VFD_FETCH_INSTR_1_5_CTX_1_ADDR A:0x1c09944
y.create.l HWIO_OXILI_VFD_FETCH_INSTR_0_6_CTX_1_ADDR A:0x1c09948
y.create.l HWIO_OXILI_VFD_FETCH_INSTR_1_6_CTX_1_ADDR A:0x1c0994c
y.create.l HWIO_OXILI_VFD_FETCH_INSTR_0_7_CTX_1_ADDR A:0x1c09950
y.create.l HWIO_OXILI_VFD_FETCH_INSTR_1_7_CTX_1_ADDR A:0x1c09954
y.create.l HWIO_OXILI_VFD_FETCH_INSTR_0_8_CTX_1_ADDR A:0x1c09958
y.create.l HWIO_OXILI_VFD_FETCH_INSTR_1_8_CTX_1_ADDR A:0x1c0995c
y.create.l HWIO_OXILI_VFD_FETCH_INSTR_0_9_CTX_1_ADDR A:0x1c09960
y.create.l HWIO_OXILI_VFD_FETCH_INSTR_1_9_CTX_1_ADDR A:0x1c09964
y.create.l HWIO_OXILI_VFD_FETCH_INSTR_0_A_CTX_1_ADDR A:0x1c09968
y.create.l HWIO_OXILI_VFD_FETCH_INSTR_1_A_CTX_1_ADDR A:0x1c0996c
y.create.l HWIO_OXILI_VFD_FETCH_INSTR_0_B_CTX_1_ADDR A:0x1c09970
y.create.l HWIO_OXILI_VFD_FETCH_INSTR_1_B_CTX_1_ADDR A:0x1c09974
y.create.l HWIO_OXILI_VFD_FETCH_INSTR_0_C_CTX_1_ADDR A:0x1c09978
y.create.l HWIO_OXILI_VFD_FETCH_INSTR_1_C_CTX_1_ADDR A:0x1c0997c
y.create.l HWIO_OXILI_VFD_FETCH_INSTR_0_D_CTX_1_ADDR A:0x1c09980
y.create.l HWIO_OXILI_VFD_FETCH_INSTR_1_D_CTX_1_ADDR A:0x1c09984
y.create.l HWIO_OXILI_VFD_FETCH_INSTR_0_E_CTX_1_ADDR A:0x1c09988
y.create.l HWIO_OXILI_VFD_FETCH_INSTR_1_E_CTX_1_ADDR A:0x1c0998c
y.create.l HWIO_OXILI_VFD_FETCH_INSTR_0_F_CTX_1_ADDR A:0x1c09990
y.create.l HWIO_OXILI_VFD_FETCH_INSTR_1_F_CTX_1_ADDR A:0x1c09994
y.create.l HWIO_OXILI_VFD_DECODE_INSTR_0_CTX_1_ADDR A:0x1c09998
y.create.l HWIO_OXILI_VFD_DECODE_INSTR_1_CTX_1_ADDR A:0x1c0999c
y.create.l HWIO_OXILI_VFD_DECODE_INSTR_2_CTX_1_ADDR A:0x1c099a0
y.create.l HWIO_OXILI_VFD_DECODE_INSTR_3_CTX_1_ADDR A:0x1c099a4
y.create.l HWIO_OXILI_VFD_DECODE_INSTR_4_CTX_1_ADDR A:0x1c099a8
y.create.l HWIO_OXILI_VFD_DECODE_INSTR_5_CTX_1_ADDR A:0x1c099ac
y.create.l HWIO_OXILI_VFD_DECODE_INSTR_6_CTX_1_ADDR A:0x1c099b0
y.create.l HWIO_OXILI_VFD_DECODE_INSTR_7_CTX_1_ADDR A:0x1c099b4
y.create.l HWIO_OXILI_VFD_DECODE_INSTR_8_CTX_1_ADDR A:0x1c099b8
y.create.l HWIO_OXILI_VFD_DECODE_INSTR_9_CTX_1_ADDR A:0x1c099bc
y.create.l HWIO_OXILI_VFD_DECODE_INSTR_10_CTX_1_ADDR A:0x1c099c0
y.create.l HWIO_OXILI_VFD_DECODE_INSTR_11_CTX_1_ADDR A:0x1c099c4
y.create.l HWIO_OXILI_VFD_DECODE_INSTR_12_CTX_1_ADDR A:0x1c099c8
y.create.l HWIO_OXILI_VFD_DECODE_INSTR_13_CTX_1_ADDR A:0x1c099cc
y.create.l HWIO_OXILI_VFD_DECODE_INSTR_14_CTX_1_ADDR A:0x1c099d0
y.create.l HWIO_OXILI_VFD_DECODE_INSTR_15_CTX_1_ADDR A:0x1c099d4
y.create.l HWIO_OXILI_VFD_DECODE_INSTR_16_CTX_1_ADDR A:0x1c099d8
y.create.l HWIO_OXILI_VFD_DECODE_INSTR_17_CTX_1_ADDR A:0x1c099dc
y.create.l HWIO_OXILI_VFD_DECODE_INSTR_18_CTX_1_ADDR A:0x1c099e0
y.create.l HWIO_OXILI_VFD_DECODE_INSTR_19_CTX_1_ADDR A:0x1c099e4
y.create.l HWIO_OXILI_VFD_DECODE_INSTR_20_CTX_1_ADDR A:0x1c099e8
y.create.l HWIO_OXILI_VFD_DECODE_INSTR_21_CTX_1_ADDR A:0x1c099ec
y.create.l HWIO_OXILI_VFD_DECODE_INSTR_22_CTX_1_ADDR A:0x1c099f0
y.create.l HWIO_OXILI_VFD_DECODE_INSTR_23_CTX_1_ADDR A:0x1c099f4
y.create.l HWIO_OXILI_VFD_VS_THREADING_THRESHOLD_CTX_1_ADDR A:0x1c099f8
y.create.l HWIO_OXILI_VPC_VPC_DEBUG_RAM_SEL_ADDR A:0x1c03984
y.create.l HWIO_OXILI_VPC_VPC_DEBUG_RAM_READ_ADDR A:0x1c03988
y.create.l HWIO_OXILI_VPC_VPC_DEBUG_ADDR A:0x1c0398c
y.create.l HWIO_OXILI_VPC_PERFCOUNTER0_SELECT_ADDR A:0x1c03990
y.create.l HWIO_OXILI_VPC_PERFCOUNTER1_SELECT_ADDR A:0x1c03994
y.create.l HWIO_OXILI_VPC_ATTR_CTX_0_ADDR A:0x1c08a00
y.create.l HWIO_OXILI_VPC_PACK_CTX_0_ADDR A:0x1c08a04
y.create.l HWIO_OXILI_VPC_VARYING_INTERP_MODE_0_CTX_0_ADDR A:0x1c08a08
y.create.l HWIO_OXILI_VPC_VARYING_INTERP_MODE_1_CTX_0_ADDR A:0x1c08a0c
y.create.l HWIO_OXILI_VPC_VARYING_INTERP_MODE_2_CTX_0_ADDR A:0x1c08a10
y.create.l HWIO_OXILI_VPC_VARYING_INTERP_MODE_3_CTX_0_ADDR A:0x1c08a14
y.create.l HWIO_OXILI_VPC_VARYING_PS_REPL_MODE_0_CTX_0_ADDR A:0x1c08a18
y.create.l HWIO_OXILI_VPC_VARYING_PS_REPL_MODE_1_CTX_0_ADDR A:0x1c08a1c
y.create.l HWIO_OXILI_VPC_VARYING_PS_REPL_MODE_2_CTX_0_ADDR A:0x1c08a20
y.create.l HWIO_OXILI_VPC_VARYING_PS_REPL_MODE_3_CTX_0_ADDR A:0x1c08a24
y.create.l HWIO_OXILI_VPC_VARY_CYLWRAP_ENABLE_0_CTX_0_ADDR A:0x1c08a28
y.create.l HWIO_OXILI_VPC_VARY_CYLWRAP_ENABLE_1_CTX_0_ADDR A:0x1c08a2c
y.create.l HWIO_OXILI_VPC_ATTR_CTX_1_ADDR A:0x1c09a00
y.create.l HWIO_OXILI_VPC_PACK_CTX_1_ADDR A:0x1c09a04
y.create.l HWIO_OXILI_VPC_VARYING_INTERP_MODE_0_CTX_1_ADDR A:0x1c09a08
y.create.l HWIO_OXILI_VPC_VARYING_INTERP_MODE_1_CTX_1_ADDR A:0x1c09a0c
y.create.l HWIO_OXILI_VPC_VARYING_INTERP_MODE_2_CTX_1_ADDR A:0x1c09a10
y.create.l HWIO_OXILI_VPC_VARYING_INTERP_MODE_3_CTX_1_ADDR A:0x1c09a14
y.create.l HWIO_OXILI_VPC_VARYING_PS_REPL_MODE_0_CTX_1_ADDR A:0x1c09a18
y.create.l HWIO_OXILI_VPC_VARYING_PS_REPL_MODE_1_CTX_1_ADDR A:0x1c09a1c
y.create.l HWIO_OXILI_VPC_VARYING_PS_REPL_MODE_2_CTX_1_ADDR A:0x1c09a20
y.create.l HWIO_OXILI_VPC_VARYING_PS_REPL_MODE_3_CTX_1_ADDR A:0x1c09a24
y.create.l HWIO_OXILI_VPC_VARY_CYLWRAP_ENABLE_0_CTX_1_ADDR A:0x1c09a28
y.create.l HWIO_OXILI_VPC_VARY_CYLWRAP_ENABLE_1_CTX_1_ADDR A:0x1c09a2c
y.create.l HWIO_OXILI_UCHE_MEM_RANGE_MIN_REG_ADDR A:0x1c03a90
y.create.l HWIO_OXILI_UCHE_MEM_RANGE_MAX_REG_ADDR A:0x1c03a94
y.create.l HWIO_OXILI_UCHE_CACHE_WAYS_VFD_REG_ADDR A:0x1c03a98
y.create.l HWIO_OXILI_UCHE_CACHE_WAYS_RB_REG_ADDR A:0x1c03a9c
y.create.l HWIO_OXILI_UCHE_CACHE_STATUS_REG_ADDR A:0x1c03a00
y.create.l HWIO_OXILI_UCHE_CACHE_DEBUG_ECO_ADDR A:0x1c03a04
y.create.l HWIO_OXILI_UCHE_CACHE_INVALIDATE0_REG_ADDR A:0x1c03a80
y.create.l HWIO_OXILI_UCHE_CACHE_INVALIDATE1_REG_ADDR A:0x1c03a84
y.create.l HWIO_OXILI_UCHE_CACHE_MODE_CONTROL_REG_ADDR A:0x1c03a08
y.create.l HWIO_OXILI_UCHE_PERFCOUNTER0_SELECT_REG_ADDR A:0x1c03a10
y.create.l HWIO_OXILI_UCHE_PERFCOUNTER1_SELECT_REG_ADDR A:0x1c03a14
y.create.l HWIO_OXILI_UCHE_PERFCOUNTER2_SELECT_REG_ADDR A:0x1c03a18
y.create.l HWIO_OXILI_UCHE_PERFCOUNTER3_SELECT_REG_ADDR A:0x1c03a1c
y.create.l HWIO_OXILI_UCHE_PERFCOUNTER4_SELECT_REG_ADDR A:0x1c03a20
y.create.l HWIO_OXILI_UCHE_PERFCOUNTER5_SELECT_REG_ADDR A:0x1c03a24
y.create.l HWIO_OXILI_SP_PERFCOUNTER0_SELECT_ADDR A:0x1c03b10
y.create.l HWIO_OXILI_SP_PERFCOUNTER1_SELECT_ADDR A:0x1c03b14
y.create.l HWIO_OXILI_SP_PERFCOUNTER2_SELECT_ADDR A:0x1c03b18
y.create.l HWIO_OXILI_SP_PERFCOUNTER3_SELECT_ADDR A:0x1c03b1c
y.create.l HWIO_OXILI_SP_PERFCOUNTER4_SELECT_ADDR A:0x1c03b20
y.create.l HWIO_OXILI_SP_PERFCOUNTER5_SELECT_ADDR A:0x1c03b24
y.create.l HWIO_OXILI_SP_PERFCOUNTER6_SELECT_ADDR A:0x1c03b28
y.create.l HWIO_OXILI_SP_PERFCOUNTER7_SELECT_ADDR A:0x1c03b2c
y.create.l HWIO_OXILI_SP_SP_MODE_CONTROL_ADDR A:0x1c03b80
y.create.l HWIO_OXILI_SP_SP_POWER_COUNTER_LOW_ADDR A:0x1c03b90
y.create.l HWIO_OXILI_SP_SP_POWER_COUNTER_HI_ADDR A:0x1c03b94
y.create.l HWIO_OXILI_SP_SP_VS_STATUS_ADDR A:0x1c03b00
y.create.l HWIO_OXILI_SP_SP_FS_STATUS_ADDR A:0x1c03b04
y.create.l HWIO_OXILI_SP_SP_DEBUG_ECO_ADDR A:0x1c03b08
y.create.l HWIO_OXILI_SP_SP_CTRL_REG_CTX_0_ADDR A:0x1c08b00
y.create.l HWIO_OXILI_SP_VS_CTRL_REG0_CTX_0_ADDR A:0x1c08b10
y.create.l HWIO_OXILI_SP_VS_CTRL_REG1_CTX_0_ADDR A:0x1c08b14
y.create.l HWIO_OXILI_SP_VS_PARAM_REG_CTX_0_ADDR A:0x1c08b18
y.create.l HWIO_OXILI_SP_VS_OUT_REG_0_CTX_0_ADDR A:0x1c08b1c
y.create.l HWIO_OXILI_SP_VS_OUT_REG_1_CTX_0_ADDR A:0x1c08b20
y.create.l HWIO_OXILI_SP_VS_OUT_REG_2_CTX_0_ADDR A:0x1c08b24
y.create.l HWIO_OXILI_SP_VS_OUT_REG_3_CTX_0_ADDR A:0x1c08b28
y.create.l HWIO_OXILI_SP_VS_OUT_REG_4_CTX_0_ADDR A:0x1c08b2c
y.create.l HWIO_OXILI_SP_VS_OUT_REG_5_CTX_0_ADDR A:0x1c08b30
y.create.l HWIO_OXILI_SP_VS_OUT_REG_6_CTX_0_ADDR A:0x1c08b34
y.create.l HWIO_OXILI_SP_VS_OUT_REG_7_CTX_0_ADDR A:0x1c08b38
y.create.l HWIO_OXILI_SP_VS_VPC_DST_REG_0_CTX_0_ADDR A:0x1c08b40
y.create.l HWIO_OXILI_SP_VS_VPC_DST_REG_1_CTX_0_ADDR A:0x1c08b44
y.create.l HWIO_OXILI_SP_VS_VPC_DST_REG_2_CTX_0_ADDR A:0x1c08b48
y.create.l HWIO_OXILI_SP_VS_VPC_DST_REG_3_CTX_0_ADDR A:0x1c08b4c
y.create.l HWIO_OXILI_SP_VS_OBJ_OFFSET_REG_CTX_0_ADDR A:0x1c08b50
y.create.l HWIO_OXILI_SP_VS_OBJ_START_REG_CTX_0_ADDR A:0x1c08b54
y.create.l HWIO_OXILI_SP_VS_PVT_MEM_PARAM_REG_CTX_0_ADDR A:0x1c08b58
y.create.l HWIO_OXILI_SP_VS_PVT_MEM_ADDR_REG_CTX_0_ADDR A:0x1c08b5c
y.create.l HWIO_OXILI_SP_VS_PVT_MEM_SIZE_REG_CTX_0_ADDR A:0x1c08b60
y.create.l HWIO_OXILI_SP_VS_LENGTH_REG_CTX_0_ADDR A:0x1c08b7c
y.create.l HWIO_OXILI_SP_FS_CTRL_REG0_CTX_0_ADDR A:0x1c08b80
y.create.l HWIO_OXILI_SP_FS_CTRL_REG1_CTX_0_ADDR A:0x1c08b84
y.create.l HWIO_OXILI_SP_FS_OBJ_OFFSET_REG_CTX_0_ADDR A:0x1c08b88
y.create.l HWIO_OXILI_SP_FS_OBJ_START_REG_CTX_0_ADDR A:0x1c08b8c
y.create.l HWIO_OXILI_SP_FS_PVT_MEM_PARAM_REG_CTX_0_ADDR A:0x1c08b90
y.create.l HWIO_OXILI_SP_FS_PVT_MEM_ADDR_REG_CTX_0_ADDR A:0x1c08b94
y.create.l HWIO_OXILI_SP_FS_PVT_MEM_SIZE_REG_CTX_0_ADDR A:0x1c08b98
y.create.l HWIO_OXILI_SP_FS_FLAT_SHAD_MODE_REG_0_CTX_0_ADDR A:0x1c08ba0
y.create.l HWIO_OXILI_SP_FS_FLAT_SHAD_MODE_REG_1_CTX_0_ADDR A:0x1c08ba4
y.create.l HWIO_OXILI_SP_FS_OUTPUT_REG_CTX_0_ADDR A:0x1c08bb0
y.create.l HWIO_OXILI_SP_FS_MRT_REG_0_CTX_0_ADDR A:0x1c08bc0
y.create.l HWIO_OXILI_SP_FS_MRT_REG_1_CTX_0_ADDR A:0x1c08bc4
y.create.l HWIO_OXILI_SP_FS_MRT_REG_2_CTX_0_ADDR A:0x1c08bc8
y.create.l HWIO_OXILI_SP_FS_MRT_REG_3_CTX_0_ADDR A:0x1c08bcc
y.create.l HWIO_OXILI_SP_FS_IMAGE_OUTPUT_REG_0_CTX_0_ADDR A:0x1c08bd0
y.create.l HWIO_OXILI_SP_FS_IMAGE_OUTPUT_REG_1_CTX_0_ADDR A:0x1c08bd4
y.create.l HWIO_OXILI_SP_FS_IMAGE_OUTPUT_REG_2_CTX_0_ADDR A:0x1c08bd8
y.create.l HWIO_OXILI_SP_FS_IMAGE_OUTPUT_REG_3_CTX_0_ADDR A:0x1c08bdc
y.create.l HWIO_OXILI_SP_FS_LENGTH_REG_CTX_0_ADDR A:0x1c08bfc
y.create.l HWIO_OXILI_SP_VS_INSTR_PORT_REG_CTX_0_ADDR A:0x1c08c00
y.create.l HWIO_OXILI_SP_FS_INSTR_PORT_REG_CTX_0_ADDR A:0x1c08c10
y.create.l HWIO_OXILI_SP_VS_CONST_PORT_REG_CTX_0_ADDR A:0x1c08c20
y.create.l HWIO_OXILI_SP_FS_CONST_PORT_REG_CTX_0_ADDR A:0x1c08c30
y.create.l HWIO_OXILI_SP_SP_CTRL_REG_CTX_1_ADDR A:0x1c09b00
y.create.l HWIO_OXILI_SP_VS_CTRL_REG0_CTX_1_ADDR A:0x1c09b10
y.create.l HWIO_OXILI_SP_VS_CTRL_REG1_CTX_1_ADDR A:0x1c09b14
y.create.l HWIO_OXILI_SP_VS_PARAM_REG_CTX_1_ADDR A:0x1c09b18
y.create.l HWIO_OXILI_SP_VS_OUT_REG_0_CTX_1_ADDR A:0x1c09b1c
y.create.l HWIO_OXILI_SP_VS_OUT_REG_1_CTX_1_ADDR A:0x1c09b20
y.create.l HWIO_OXILI_SP_VS_OUT_REG_2_CTX_1_ADDR A:0x1c09b24
y.create.l HWIO_OXILI_SP_VS_OUT_REG_3_CTX_1_ADDR A:0x1c09b28
y.create.l HWIO_OXILI_SP_VS_OUT_REG_4_CTX_1_ADDR A:0x1c09b2c
y.create.l HWIO_OXILI_SP_VS_OUT_REG_5_CTX_1_ADDR A:0x1c09b30
y.create.l HWIO_OXILI_SP_VS_OUT_REG_6_CTX_1_ADDR A:0x1c09b34
y.create.l HWIO_OXILI_SP_VS_OUT_REG_7_CTX_1_ADDR A:0x1c09b38
y.create.l HWIO_OXILI_SP_VS_VPC_DST_REG_0_CTX_1_ADDR A:0x1c09b40
y.create.l HWIO_OXILI_SP_VS_VPC_DST_REG_1_CTX_1_ADDR A:0x1c09b44
y.create.l HWIO_OXILI_SP_VS_VPC_DST_REG_2_CTX_1_ADDR A:0x1c09b48
y.create.l HWIO_OXILI_SP_VS_VPC_DST_REG_3_CTX_1_ADDR A:0x1c09b4c
y.create.l HWIO_OXILI_SP_VS_OBJ_OFFSET_REG_CTX_1_ADDR A:0x1c09b50
y.create.l HWIO_OXILI_SP_VS_OBJ_START_REG_CTX_1_ADDR A:0x1c09b54
y.create.l HWIO_OXILI_SP_VS_PVT_MEM_PARAM_REG_CTX_1_ADDR A:0x1c09b58
y.create.l HWIO_OXILI_SP_VS_PVT_MEM_ADDR_REG_CTX_1_ADDR A:0x1c09b5c
y.create.l HWIO_OXILI_SP_VS_PVT_MEM_SIZE_REG_CTX_1_ADDR A:0x1c09b60
y.create.l HWIO_OXILI_SP_VS_LENGTH_REG_CTX_1_ADDR A:0x1c09b7c
y.create.l HWIO_OXILI_SP_FS_CTRL_REG0_CTX_1_ADDR A:0x1c09b80
y.create.l HWIO_OXILI_SP_FS_CTRL_REG1_CTX_1_ADDR A:0x1c09b84
y.create.l HWIO_OXILI_SP_FS_OBJ_OFFSET_REG_CTX_1_ADDR A:0x1c09b88
y.create.l HWIO_OXILI_SP_FS_OBJ_START_REG_CTX_1_ADDR A:0x1c09b8c
y.create.l HWIO_OXILI_SP_FS_PVT_MEM_PARAM_REG_CTX_1_ADDR A:0x1c09b90
y.create.l HWIO_OXILI_SP_FS_PVT_MEM_ADDR_REG_CTX_1_ADDR A:0x1c09b94
y.create.l HWIO_OXILI_SP_FS_PVT_MEM_SIZE_REG_CTX_1_ADDR A:0x1c09b98
y.create.l HWIO_OXILI_SP_FS_FLAT_SHAD_MODE_REG_0_CTX_1_ADDR A:0x1c09ba0
y.create.l HWIO_OXILI_SP_FS_FLAT_SHAD_MODE_REG_1_CTX_1_ADDR A:0x1c09ba4
y.create.l HWIO_OXILI_SP_FS_OUTPUT_REG_CTX_1_ADDR A:0x1c09bb0
y.create.l HWIO_OXILI_SP_FS_MRT_REG_0_CTX_1_ADDR A:0x1c09bc0
y.create.l HWIO_OXILI_SP_FS_MRT_REG_1_CTX_1_ADDR A:0x1c09bc4
y.create.l HWIO_OXILI_SP_FS_MRT_REG_2_CTX_1_ADDR A:0x1c09bc8
y.create.l HWIO_OXILI_SP_FS_MRT_REG_3_CTX_1_ADDR A:0x1c09bcc
y.create.l HWIO_OXILI_SP_FS_IMAGE_OUTPUT_REG_0_CTX_1_ADDR A:0x1c09bd0
y.create.l HWIO_OXILI_SP_FS_IMAGE_OUTPUT_REG_1_CTX_1_ADDR A:0x1c09bd4
y.create.l HWIO_OXILI_SP_FS_IMAGE_OUTPUT_REG_2_CTX_1_ADDR A:0x1c09bd8
y.create.l HWIO_OXILI_SP_FS_IMAGE_OUTPUT_REG_3_CTX_1_ADDR A:0x1c09bdc
y.create.l HWIO_OXILI_SP_FS_LENGTH_REG_CTX_1_ADDR A:0x1c09bfc
y.create.l HWIO_OXILI_SP_VS_INSTR_PORT_REG_CTX_1_ADDR A:0x1c09c00
y.create.l HWIO_OXILI_SP_FS_INSTR_PORT_REG_CTX_1_ADDR A:0x1c09c10
y.create.l HWIO_OXILI_SP_VS_CONST_PORT_REG_CTX_1_ADDR A:0x1c09c20
y.create.l HWIO_OXILI_SP_FS_CONST_PORT_REG_CTX_1_ADDR A:0x1c09c30
y.create.l HWIO_OXILI_TPL1_TP_DEBUG_ECO_ADDR A:0x1c03c00
y.create.l HWIO_OXILI_TPL1_TP_STATUS0_ADDR A:0x1c03c04
y.create.l HWIO_OXILI_TPL1_TP_MODE_CONTROL_ADDR A:0x1c03c0c
y.create.l HWIO_OXILI_TPL1_TP_PERFCOUNTER0_SELECT_ADDR A:0x1c03c10
y.create.l HWIO_OXILI_TPL1_TP_PERFCOUNTER1_SELECT_ADDR A:0x1c03c14
y.create.l HWIO_OXILI_TPL1_TP_PERFCOUNTER2_SELECT_ADDR A:0x1c03c18
y.create.l HWIO_OXILI_TPL1_TP_PERFCOUNTER3_SELECT_ADDR A:0x1c03c1c
y.create.l HWIO_OXILI_TPL1_TP_PERFCOUNTER4_SELECT_ADDR A:0x1c03c20
y.create.l HWIO_OXILI_TPL1_TP_PERFCOUNTER5_SELECT_ADDR A:0x1c03c24
y.create.l HWIO_OXILI_TPL1_TP_VS_TEX_OFFSET_CTX_0_ADDR A:0x1c08d00
y.create.l HWIO_OXILI_TPL1_TP_FS_TEX_OFFSET_CTX_0_ADDR A:0x1c08d08
y.create.l HWIO_OXILI_TPL1_TP_VS_BORDER_COLOR_BASE_ADDR_CTX_0_ADDR A:0x1c08d04
y.create.l HWIO_OXILI_TPL1_TP_FS_BORDER_COLOR_BASE_ADDR_CTX_0_ADDR A:0x1c08d0c
y.create.l HWIO_OXILI_TPL1_TP_SAMPLER_0_CTX_0_ADDR A:0x1c08d20
y.create.l HWIO_OXILI_TPL1_TP_SAMPLER_1_CTX_0_ADDR A:0x1c08d24
y.create.l HWIO_OXILI_TPL1_TP_TEXMEM_OBJ_0_CTX_0_ADDR A:0x1c08d40
y.create.l HWIO_OXILI_TPL1_TP_TEXMEM_OBJ_1_CTX_0_ADDR A:0x1c08d44
y.create.l HWIO_OXILI_TPL1_TP_TEXMEM_OBJ_2_CTX_0_ADDR A:0x1c08d48
y.create.l HWIO_OXILI_TPL1_TP_TEXMEM_OBJ_3_CTX_0_ADDR A:0x1c08d4c
y.create.l HWIO_OXILI_TPL1_TP_TEXMEM_OBJ_4_CTX_0_ADDR A:0x1c08d50
y.create.l HWIO_OXILI_TPL1_TP_TEXMEM_OBJ_5_CTX_0_ADDR A:0x1c08d54
y.create.l HWIO_OXILI_TPL1_TP_TEXMEM_OBJ_6_CTX_0_ADDR A:0x1c08d58
y.create.l HWIO_OXILI_TPL1_MIPMAP_ADDR_PORT_REG_CTX_0_ADDR A:0x1c08d80
y.create.l HWIO_OXILI_TPL1_TP_VS_TEX_OFFSET_CTX_1_ADDR A:0x1c09d00
y.create.l HWIO_OXILI_TPL1_TP_FS_TEX_OFFSET_CTX_1_ADDR A:0x1c09d08
y.create.l HWIO_OXILI_TPL1_TP_VS_BORDER_COLOR_BASE_ADDR_CTX_1_ADDR A:0x1c09d04
y.create.l HWIO_OXILI_TPL1_TP_FS_BORDER_COLOR_BASE_ADDR_CTX_1_ADDR A:0x1c09d0c
y.create.l HWIO_OXILI_TPL1_TP_SAMPLER_0_CTX_1_ADDR A:0x1c09d20
y.create.l HWIO_OXILI_TPL1_TP_SAMPLER_1_CTX_1_ADDR A:0x1c09d24
y.create.l HWIO_OXILI_TPL1_TP_TEXMEM_OBJ_0_CTX_1_ADDR A:0x1c09d40
y.create.l HWIO_OXILI_TPL1_TP_TEXMEM_OBJ_1_CTX_1_ADDR A:0x1c09d44
y.create.l HWIO_OXILI_TPL1_TP_TEXMEM_OBJ_2_CTX_1_ADDR A:0x1c09d48
y.create.l HWIO_OXILI_TPL1_TP_TEXMEM_OBJ_3_CTX_1_ADDR A:0x1c09d4c
y.create.l HWIO_OXILI_TPL1_TP_TEXMEM_OBJ_4_CTX_1_ADDR A:0x1c09d50
y.create.l HWIO_OXILI_TPL1_TP_TEXMEM_OBJ_5_CTX_1_ADDR A:0x1c09d54
y.create.l HWIO_OXILI_TPL1_TP_TEXMEM_OBJ_6_CTX_1_ADDR A:0x1c09d58
y.create.l HWIO_OXILI_TPL1_MIPMAP_ADDR_PORT_REG_CTX_1_ADDR A:0x1c09d80
y.create.l HWIO_OXILI_RB_GMEM_BASE_ADDR_ADDR A:0x1c03300
y.create.l HWIO_OXILI_RB_DEBUG_ECO_CONTROLS_ADDR_ADDR A:0x1c03304
y.create.l HWIO_OXILI_RB_PERF_COUNTER0_SEL_ADDR A:0x1c03318
y.create.l HWIO_OXILI_RB_PERF_COUNTER1_SEL_ADDR A:0x1c0331c
y.create.l HWIO_OXILI_RB_FRAME_BUFFER_DIMENSION_ADDR A:0x1c03380
y.create.l HWIO_OXILI_RB_MARB_POWER_COUNTER_LOW_ADDR A:0x1c03390
y.create.l HWIO_OXILI_RB_MARB_POWER_COUNTER_HI_ADDR A:0x1c03394
y.create.l HWIO_OXILI_RB_MODE_CONTROL_CTX_0_ADDR A:0x1c08300
y.create.l HWIO_OXILI_RB_RENDER_CONTROL_CTX_0_ADDR A:0x1c08304
y.create.l HWIO_OXILI_RB_MSAA_CONTROL_CTX_0_ADDR A:0x1c08308
y.create.l HWIO_OXILI_RB_ALPHA_REFERENCE_CTX_0_ADDR A:0x1c0830c
y.create.l HWIO_OXILI_RB_MRT_CONTROL0_CTX_0_ADDR A:0x1c08310
y.create.l HWIO_OXILI_RB_MRT_CONTROL1_CTX_0_ADDR A:0x1c08320
y.create.l HWIO_OXILI_RB_MRT_CONTROL2_CTX_0_ADDR A:0x1c08330
y.create.l HWIO_OXILI_RB_MRT_CONTROL3_CTX_0_ADDR A:0x1c08340
y.create.l HWIO_OXILI_RB_MRT_BUF_INFO0_CTX_0_ADDR A:0x1c08314
y.create.l HWIO_OXILI_RB_MRT_BUF_INFO1_CTX_0_ADDR A:0x1c08324
y.create.l HWIO_OXILI_RB_MRT_BUF_INFO2_CTX_0_ADDR A:0x1c08334
y.create.l HWIO_OXILI_RB_MRT_BUF_INFO3_CTX_0_ADDR A:0x1c08344
y.create.l HWIO_OXILI_RB_MRT_BUF_BASE0_CTX_0_ADDR A:0x1c08318
y.create.l HWIO_OXILI_RB_MRT_BUF_BASE1_CTX_0_ADDR A:0x1c08328
y.create.l HWIO_OXILI_RB_MRT_BUF_BASE2_CTX_0_ADDR A:0x1c08338
y.create.l HWIO_OXILI_RB_MRT_BUF_BASE3_CTX_0_ADDR A:0x1c08348
y.create.l HWIO_OXILI_RB_MRT_BLEND_CONTROL0_CTX_0_ADDR A:0x1c0831c
y.create.l HWIO_OXILI_RB_MRT_BLEND_CONTROL1_CTX_0_ADDR A:0x1c0832c
y.create.l HWIO_OXILI_RB_MRT_BLEND_CONTROL2_CTX_0_ADDR A:0x1c0833c
y.create.l HWIO_OXILI_RB_MRT_BLEND_CONTROL3_CTX_0_ADDR A:0x1c0834c
y.create.l HWIO_OXILI_RB_BLEND_RED_CTX_0_ADDR A:0x1c08390
y.create.l HWIO_OXILI_RB_BLEND_GREEN_CTX_0_ADDR A:0x1c08394
y.create.l HWIO_OXILI_RB_BLEND_BLUE_CTX_0_ADDR A:0x1c08398
y.create.l HWIO_OXILI_RB_BLEND_ALPHA_CTX_0_ADDR A:0x1c0839c
y.create.l HWIO_OXILI_RB_CLEAR_COLOR_DW0_CTX_0_ADDR A:0x1c083a0
y.create.l HWIO_OXILI_RB_CLEAR_COLOR_DW1_CTX_0_ADDR A:0x1c083a4
y.create.l HWIO_OXILI_RB_CLEAR_COLOR_DW2_CTX_0_ADDR A:0x1c083a8
y.create.l HWIO_OXILI_RB_CLEAR_COLOR_DW3_CTX_0_ADDR A:0x1c083ac
y.create.l HWIO_OXILI_RB_COPY_CONTROL_CTX_0_ADDR A:0x1c083b0
y.create.l HWIO_OXILI_RB_COPY_DEST_BASE_CTX_0_ADDR A:0x1c083b4
y.create.l HWIO_OXILI_RB_COPY_DEST_PITCH_CTX_0_ADDR A:0x1c083b8
y.create.l HWIO_OXILI_RB_COPY_DEST_INFO_CTX_0_ADDR A:0x1c083bc
y.create.l HWIO_OXILI_RB_DEPTH_CONTROL_CTX_0_ADDR A:0x1c08400
y.create.l HWIO_OXILI_RB_DEPTH_CLEAR_CTX_0_ADDR A:0x1c08404
y.create.l HWIO_OXILI_RB_DEPTH_BUF_INFO_CTX_0_ADDR A:0x1c08408
y.create.l HWIO_OXILI_RB_DEPTH_BUF_PITCH_CTX_0_ADDR A:0x1c0840c
y.create.l HWIO_OXILI_RB_STENCIL_CONTROL_CTX_0_ADDR A:0x1c08410
y.create.l HWIO_OXILI_RB_STENCIL_CLEAR_CTX_0_ADDR A:0x1c08414
y.create.l HWIO_OXILI_RB_STENCIL_BUF_INFO_CTX_0_ADDR A:0x1c08418
y.create.l HWIO_OXILI_RB_STENCIL_BUF_PITCH_CTX_0_ADDR A:0x1c0841c
y.create.l HWIO_OXILI_RB_STENCIL_REF_MASK_CTX_0_ADDR A:0x1c08420
y.create.l HWIO_OXILI_RB_STENCIL_REF_MASK_BF_CTX_0_ADDR A:0x1c08424
y.create.l HWIO_OXILI_RB_LRZ_VSC_CONTROL_CTX_0_ADDR A:0x1c08430
y.create.l HWIO_OXILI_RB_WINDOW_OFFSET_CTX_0_ADDR A:0x1c08438
y.create.l HWIO_OXILI_RB_SAMPLE_COUNT_CONTROL_CTX_0_ADDR A:0x1c08440
y.create.l HWIO_OXILI_RB_SAMPLE_COUNT_ADDR_CTX_0_ADDR A:0x1c08444
y.create.l HWIO_OXILI_RB_Z_CLAMP_MIN_CTX_0_ADDR A:0x1c08450
y.create.l HWIO_OXILI_RB_Z_CLAMP_MAX_CTX_0_ADDR A:0x1c08454
y.create.l HWIO_OXILI_RB_MODE_CONTROL_CTX_1_ADDR A:0x1c09300
y.create.l HWIO_OXILI_RB_RENDER_CONTROL_CTX_1_ADDR A:0x1c09304
y.create.l HWIO_OXILI_RB_MSAA_CONTROL_CTX_1_ADDR A:0x1c09308
y.create.l HWIO_OXILI_RB_ALPHA_REFERENCE_CTX_1_ADDR A:0x1c0930c
y.create.l HWIO_OXILI_RB_MRT_CONTROL0_CTX_1_ADDR A:0x1c09310
y.create.l HWIO_OXILI_RB_MRT_CONTROL1_CTX_1_ADDR A:0x1c09320
y.create.l HWIO_OXILI_RB_MRT_CONTROL2_CTX_1_ADDR A:0x1c09330
y.create.l HWIO_OXILI_RB_MRT_CONTROL3_CTX_1_ADDR A:0x1c09340
y.create.l HWIO_OXILI_RB_MRT_BUF_INFO0_CTX_1_ADDR A:0x1c09314
y.create.l HWIO_OXILI_RB_MRT_BUF_INFO1_CTX_1_ADDR A:0x1c09324
y.create.l HWIO_OXILI_RB_MRT_BUF_INFO2_CTX_1_ADDR A:0x1c09334
y.create.l HWIO_OXILI_RB_MRT_BUF_INFO3_CTX_1_ADDR A:0x1c09344
y.create.l HWIO_OXILI_RB_MRT_BUF_BASE0_CTX_1_ADDR A:0x1c09318
y.create.l HWIO_OXILI_RB_MRT_BUF_BASE1_CTX_1_ADDR A:0x1c09328
y.create.l HWIO_OXILI_RB_MRT_BUF_BASE2_CTX_1_ADDR A:0x1c09338
y.create.l HWIO_OXILI_RB_MRT_BUF_BASE3_CTX_1_ADDR A:0x1c09348
y.create.l HWIO_OXILI_RB_MRT_BLEND_CONTROL0_CTX_1_ADDR A:0x1c0931c
y.create.l HWIO_OXILI_RB_MRT_BLEND_CONTROL1_CTX_1_ADDR A:0x1c0932c
y.create.l HWIO_OXILI_RB_MRT_BLEND_CONTROL2_CTX_1_ADDR A:0x1c0933c
y.create.l HWIO_OXILI_RB_MRT_BLEND_CONTROL3_CTX_1_ADDR A:0x1c0934c
y.create.l HWIO_OXILI_RB_BLEND_RED_CTX_1_ADDR A:0x1c09390
y.create.l HWIO_OXILI_RB_BLEND_GREEN_CTX_1_ADDR A:0x1c09394
y.create.l HWIO_OXILI_RB_BLEND_BLUE_CTX_1_ADDR A:0x1c09398
y.create.l HWIO_OXILI_RB_BLEND_ALPHA_CTX_1_ADDR A:0x1c0939c
y.create.l HWIO_OXILI_RB_CLEAR_COLOR_DW0_CTX_1_ADDR A:0x1c093a0
y.create.l HWIO_OXILI_RB_CLEAR_COLOR_DW1_CTX_1_ADDR A:0x1c093a4
y.create.l HWIO_OXILI_RB_CLEAR_COLOR_DW2_CTX_1_ADDR A:0x1c093a8
y.create.l HWIO_OXILI_RB_CLEAR_COLOR_DW3_CTX_1_ADDR A:0x1c093ac
y.create.l HWIO_OXILI_RB_COPY_CONTROL_CTX_1_ADDR A:0x1c093b0
y.create.l HWIO_OXILI_RB_COPY_DEST_BASE_CTX_1_ADDR A:0x1c093b4
y.create.l HWIO_OXILI_RB_COPY_DEST_PITCH_CTX_1_ADDR A:0x1c093b8
y.create.l HWIO_OXILI_RB_COPY_DEST_INFO_CTX_1_ADDR A:0x1c093bc
y.create.l HWIO_OXILI_RB_DEPTH_CONTROL_CTX_1_ADDR A:0x1c09400
y.create.l HWIO_OXILI_RB_DEPTH_CLEAR_CTX_1_ADDR A:0x1c09404
y.create.l HWIO_OXILI_RB_DEPTH_BUF_INFO_CTX_1_ADDR A:0x1c09408
y.create.l HWIO_OXILI_RB_DEPTH_BUF_PITCH_CTX_1_ADDR A:0x1c0940c
y.create.l HWIO_OXILI_RB_STENCIL_CONTROL_CTX_1_ADDR A:0x1c09410
y.create.l HWIO_OXILI_RB_STENCIL_CLEAR_CTX_1_ADDR A:0x1c09414
y.create.l HWIO_OXILI_RB_STENCIL_BUF_INFO_CTX_1_ADDR A:0x1c09418
y.create.l HWIO_OXILI_RB_STENCIL_BUF_PITCH_CTX_1_ADDR A:0x1c0941c
y.create.l HWIO_OXILI_RB_STENCIL_REF_MASK_CTX_1_ADDR A:0x1c09420
y.create.l HWIO_OXILI_RB_STENCIL_REF_MASK_BF_CTX_1_ADDR A:0x1c09424
y.create.l HWIO_OXILI_RB_LRZ_VSC_CONTROL_CTX_1_ADDR A:0x1c09430
y.create.l HWIO_OXILI_RB_WINDOW_OFFSET_CTX_1_ADDR A:0x1c09438
y.create.l HWIO_OXILI_RB_SAMPLE_COUNT_CONTROL_CTX_1_ADDR A:0x1c09440
y.create.l HWIO_OXILI_RB_SAMPLE_COUNT_ADDR_CTX_1_ADDR A:0x1c09444
y.create.l HWIO_OXILI_RB_Z_CLAMP_MIN_CTX_1_ADDR A:0x1c09450
y.create.l HWIO_OXILI_RB_Z_CLAMP_MAX_CTX_1_ADDR A:0x1c09454
y.create.l HWIO_OXILI_VSC_BIN_SIZE_ADDR A:0x1c03004
y.create.l HWIO_OXILI_VSC_PIPE_CONFIG_0_ADDR A:0x1c03018
y.create.l HWIO_OXILI_VSC_PIPE_CONFIG_1_ADDR A:0x1c03024
y.create.l HWIO_OXILI_VSC_PIPE_CONFIG_2_ADDR A:0x1c03030
y.create.l HWIO_OXILI_VSC_PIPE_CONFIG_3_ADDR A:0x1c0303c
y.create.l HWIO_OXILI_VSC_PIPE_CONFIG_4_ADDR A:0x1c03048
y.create.l HWIO_OXILI_VSC_PIPE_CONFIG_5_ADDR A:0x1c03054
y.create.l HWIO_OXILI_VSC_PIPE_CONFIG_6_ADDR A:0x1c03060
y.create.l HWIO_OXILI_VSC_PIPE_CONFIG_7_ADDR A:0x1c0306c
y.create.l HWIO_OXILI_VSC_PIPE_DATA_ADDRESS_0_ADDR A:0x1c0301c
y.create.l HWIO_OXILI_VSC_PIPE_DATA_ADDRESS_1_ADDR A:0x1c03028
y.create.l HWIO_OXILI_VSC_PIPE_DATA_ADDRESS_2_ADDR A:0x1c03034
y.create.l HWIO_OXILI_VSC_PIPE_DATA_ADDRESS_3_ADDR A:0x1c03040
y.create.l HWIO_OXILI_VSC_PIPE_DATA_ADDRESS_4_ADDR A:0x1c0304c
y.create.l HWIO_OXILI_VSC_PIPE_DATA_ADDRESS_5_ADDR A:0x1c03058
y.create.l HWIO_OXILI_VSC_PIPE_DATA_ADDRESS_6_ADDR A:0x1c03064
y.create.l HWIO_OXILI_VSC_PIPE_DATA_ADDRESS_7_ADDR A:0x1c03070
y.create.l HWIO_OXILI_VSC_PIPE_DATA_LENGTH_0_ADDR A:0x1c03020
y.create.l HWIO_OXILI_VSC_PIPE_DATA_LENGTH_1_ADDR A:0x1c0302c
y.create.l HWIO_OXILI_VSC_PIPE_DATA_LENGTH_2_ADDR A:0x1c03038
y.create.l HWIO_OXILI_VSC_PIPE_DATA_LENGTH_3_ADDR A:0x1c03044
y.create.l HWIO_OXILI_VSC_PIPE_DATA_LENGTH_4_ADDR A:0x1c03050
y.create.l HWIO_OXILI_VSC_PIPE_DATA_LENGTH_5_ADDR A:0x1c0305c
y.create.l HWIO_OXILI_VSC_PIPE_DATA_LENGTH_6_ADDR A:0x1c03068
y.create.l HWIO_OXILI_VSC_PIPE_DATA_LENGTH_7_ADDR A:0x1c03074
y.create.l HWIO_OXILI_VSC_SIZE_ADDRESS_ADDR A:0x1c03008
y.create.l HWIO_OXILI_VSC_VSC_DEBUG_CONTROL_CTX_0_ADDR A:0x1c03460
y.create.l HWIO_OXILI_VBIF_VERSION_ADDR A:0x1c0c000
y.create.l HWIO_OXILI_VBIF_CLKON_ADDR A:0x1c0c004
y.create.l HWIO_OXILI_VBIF_CLK_FORCE_CTRL0_ADDR A:0x1c0c008
y.create.l HWIO_OXILI_VBIF_CLK_FORCE_CTRL1_ADDR A:0x1c0c00c
y.create.l HWIO_OXILI_VBIF_QOS_OVERRIDE_EN_ADDR A:0x1c0c010
y.create.l HWIO_OXILI_VBIF_PRILVL_ACT_PROP_EN_ADDR A:0x1c0c014
y.create.l HWIO_OXILI_VBIF_QOS_OVERRIDE_REQPRI_ADDR A:0x1c0c018
y.create.l HWIO_OXILI_VBIF_QOS_OVERRIDE_PRILVL_ADDR A:0x1c0c01c
y.create.l HWIO_OXILI_VBIF_QOS_REMAP_00_ADDR A:0x1c0c020
y.create.l HWIO_OXILI_VBIF_QOS_REMAP_01_ADDR A:0x1c0c024
y.create.l HWIO_OXILI_VBIF_QOS_REMAP_10_ADDR A:0x1c0c028
y.create.l HWIO_OXILI_VBIF_QOS_REMAP_11_ADDR A:0x1c0c02c
y.create.l HWIO_OXILI_VBIF_WRITE_GATHER_EN_ADDR A:0x1c0c0ac
y.create.l HWIO_OXILI_VBIF_IN_RD_LIM_CONF0_ADDR A:0x1c0c0b0
y.create.l HWIO_OXILI_VBIF_IN_WR_LIM_CONF0_ADDR A:0x1c0c0c0
y.create.l HWIO_OXILI_VBIF_OUT_RD_LIM_CONF0_ADDR A:0x1c0c0d0
y.create.l HWIO_OXILI_VBIF_OUT_WR_LIM_CONF0_ADDR A:0x1c0c0d4
y.create.l HWIO_OXILI_VBIF_DDR_OUT_MAX_BURST_ADDR A:0x1c0c0d8
y.create.l HWIO_OXILI_VBIF_ISO_SYNC_ADDR A:0x1c0c0e0
y.create.l HWIO_OXILI_VBIF_ARB_CTL_ADDR A:0x1c0c0f0
y.create.l HWIO_OXILI_VBIF_DDR_ARB_CONF0_ADDR A:0x1c0c0f4
y.create.l HWIO_OXILI_VBIF_FIXED_ARB_CONF0_ADDR A:0x1c0c100
y.create.l HWIO_OXILI_VBIF_ROUND_ROBIN_QOS_ARB_ADDR A:0x1c0c124
y.create.l HWIO_OXILI_VBIF_OUT_AXI_AMEMTYPE_CONF0_ADDR A:0x1c0c160
y.create.l HWIO_OXILI_VBIF_OUT_AXI_AINST_OVERRIDE_EN_ADDR A:0x1c0c168
y.create.l HWIO_OXILI_VBIF_OUT_AXI_AINST_ADDR A:0x1c0c16c
y.create.l HWIO_OXILI_VBIF_OUT_AXI_ASHARED_ADDR A:0x1c0c170
y.create.l HWIO_OXILI_VBIF_OUT_AXI_AINNERSHARED_ADDR A:0x1c0c174
y.create.l HWIO_OXILI_VBIF_OUT_AXI_AOOO_EN_ADDR A:0x1c0c178
y.create.l HWIO_OXILI_VBIF_OUT_AXI_AOOO_ADDR A:0x1c0c17c
y.create.l HWIO_OXILI_VBIF_OUT_AXI_ANOALLOCATE_ADDR A:0x1c0c180
y.create.l HWIO_OXILI_VBIF_WD_TIMEOUT_ADDR A:0x1c0c184
y.create.l HWIO_OXILI_VBIF_PND_ERR_ADDR A:0x1c0c190
y.create.l HWIO_OXILI_VBIF_SRC_ERR_ADDR A:0x1c0c194
y.create.l HWIO_OXILI_VBIF_ERR_MASK_ADDR A:0x1c0c198
y.create.l HWIO_OXILI_VBIF_ERR_CLR_ADDR A:0x1c0c19c
y.create.l HWIO_OXILI_VBIF_ERR_INFO_ADDR A:0x1c0c1a0
y.create.l HWIO_OXILI_VBIF_AXI_TEST_CTL_ADDR A:0x1c0c1b0
y.create.l HWIO_OXILI_VBIF_AXI_TEST_OUT_ADDR A:0x1c0c1b4
y.create.l HWIO_OXILI_VBIF_XIN_HALT_CTRL0_ADDR A:0x1c0c200
y.create.l HWIO_OXILI_VBIF_XIN_HALT_CTRL1_ADDR A:0x1c0c204
y.create.l HWIO_OXILI_VBIF_AXI_HALT_CTRL0_ADDR A:0x1c0c208
y.create.l HWIO_OXILI_VBIF_AXI_HALT_CTRL1_ADDR A:0x1c0c20c
y.create.l HWIO_OXILI_VBIF_TEST_BUS_OUT_CTRL_ADDR A:0x1c0c210
y.create.l HWIO_OXILI_VBIF_TEST_BUS1_CTRL0_ADDR A:0x1c0c214
y.create.l HWIO_OXILI_VBIF_TEST_BUS1_CTRL1_ADDR A:0x1c0c218
y.create.l HWIO_OXILI_VBIF_TEST_BUS2_CTRL0_ADDR A:0x1c0c21c
y.create.l HWIO_OXILI_VBIF_TEST_BUS2_CTRL1_ADDR A:0x1c0c220
y.create.l HWIO_OXILI_VBIF_TEST_BUS_AHB_CTRL_ADDR A:0x1c0c22c
y.create.l HWIO_OXILI_VBIF_TEST_BUS_OUT_ADDR A:0x1c0c230
y.create.l HWIO_OXILI_VBIF_ATB_CONF0_ADDR A:0x1c0c240
y.create.l HWIO_OXILI_VBIF_ATB_CONF1_ADDR A:0x1c0c244
y.create.l HWIO_OXILI_VBIF_ATB_CONF2_ADDR A:0x1c0c248
y.create.l HWIO_OXILI_VBIF_ATB_CONF3_ADDR A:0x1c0c24c
y.create.l HWIO_OXILI_VBIF_ATB_TEST_VALUE_ADDR A:0x1c0c250
y.create.l HWIO_OXILI_VBIF_STM_CONF_ADDR A:0x1c0c260
y.create.l HWIO_OXILI_VBIF_WR_BUF_FOR_AP_ADDR A:0x1c0c270
y.create.l HWIO_OXILI_VBIF_PERF_CNT_EN0_ADDR A:0x1c0c300
y.create.l HWIO_OXILI_VBIF_PERF_CNT_EN1_ADDR A:0x1c0c304
y.create.l HWIO_OXILI_VBIF_PERF_CNT_EN2_ADDR A:0x1c0c308
y.create.l HWIO_OXILI_VBIF_PERF_CNT_EN3_ADDR A:0x1c0c30c
y.create.l HWIO_OXILI_VBIF_PERF_CNT_CLR0_ADDR A:0x1c0c320
y.create.l HWIO_OXILI_VBIF_PERF_CNT_CLR1_ADDR A:0x1c0c324
y.create.l HWIO_OXILI_VBIF_PERF_CNT_CLR2_ADDR A:0x1c0c328
y.create.l HWIO_OXILI_VBIF_PERF_CNT_CLR3_ADDR A:0x1c0c32c
y.create.l HWIO_OXILI_VBIF_PERF_CNT_SEL0_ADDR A:0x1c0c340
y.create.l HWIO_OXILI_VBIF_PERF_CNT_SEL1_ADDR A:0x1c0c344
y.create.l HWIO_OXILI_VBIF_PERF_CNT_SEL2_ADDR A:0x1c0c348
y.create.l HWIO_OXILI_VBIF_PERF_CNT_SEL3_ADDR A:0x1c0c34c
y.create.l HWIO_OXILI_VBIF_PERF_CNT_L0_ADDR A:0x1c0c360
y.create.l HWIO_OXILI_VBIF_PERF_CNT_L1_ADDR A:0x1c0c364
y.create.l HWIO_OXILI_VBIF_PERF_CNT_L2_ADDR A:0x1c0c368
y.create.l HWIO_OXILI_VBIF_PERF_CNT_L3_ADDR A:0x1c0c36c
y.create.l HWIO_OXILI_VBIF_PERF_CNT_H0_ADDR A:0x1c0c380
y.create.l HWIO_OXILI_VBIF_PERF_CNT_H1_ADDR A:0x1c0c384
y.create.l HWIO_OXILI_VBIF_PERF_CNT_H2_ADDR A:0x1c0c388
y.create.l HWIO_OXILI_VBIF_PERF_CNT_H3_ADDR A:0x1c0c38c
y.create.l HWIO_OXILI_VBIF_PERF_PWR_CNT_EN0_ADDR A:0x1c0c400
y.create.l HWIO_OXILI_VBIF_PERF_PWR_CNT_EN1_ADDR A:0x1c0c404
y.create.l HWIO_OXILI_VBIF_PERF_PWR_CNT_EN2_ADDR A:0x1c0c408
y.create.l HWIO_OXILI_VBIF_PERF_PWR_CNT_CLR0_ADDR A:0x1c0c420
y.create.l HWIO_OXILI_VBIF_PERF_PWR_CNT_CLR1_ADDR A:0x1c0c424
y.create.l HWIO_OXILI_VBIF_PERF_PWR_CNT_CLR2_ADDR A:0x1c0c428
y.create.l HWIO_OXILI_VBIF_PERF_PWR_CNT_L0_ADDR A:0x1c0c440
y.create.l HWIO_OXILI_VBIF_PERF_PWR_CNT_L1_ADDR A:0x1c0c444
y.create.l HWIO_OXILI_VBIF_PERF_PWR_CNT_L2_ADDR A:0x1c0c448
y.create.l HWIO_OXILI_VBIF_PERF_PWR_CNT_H0_ADDR A:0x1c0c460
y.create.l HWIO_OXILI_VBIF_PERF_PWR_CNT_H1_ADDR A:0x1c0c464
y.create.l HWIO_OXILI_VBIF_PERF_PWR_CNT_H2_ADDR A:0x1c0c468
y.create.l HWIO_OXILI_VBIF_MISR_CFG_A0_ADDR A:0x1c0c480
y.create.l HWIO_OXILI_VBIF_MISR_COUNTER_ADDR A:0x1c0c490
y.create.l HWIO_OXILI_VBIF_MISR_CLR_A0_ADDR A:0x1c0c494
y.create.l HWIO_OXILI_VBIF_MISR_A0_SIG0_ADDR A:0x1c0c4a4
y.create.l HWIO_OXILI_VBIF_MISR_A0_SIG1_ADDR A:0x1c0c4a8
y.create.l HWIO_OXILI_VBIF_MISR_A0_SIG2_ADDR A:0x1c0c4ac
y.create.l HWIO_OXILI_VBIF_MISR_A0_SIG3_ADDR A:0x1c0c4b0
y.create.l HWIO_OXILI_VBIF_ATB_EN_ADDR A:0x1c0d030
y.create.l HWIO_OXILI_VBIF_STM_EN_ADDR A:0x1c0d040
y.create.l HWIO_OXILI_VBIF_DDR_OUTPUT_RECOVERABLE_HALT_CTRL0_ADDR A:0x1c0e000
y.create.l HWIO_OXILI_VBIF_DDR_OUTPUT_RECOVERABLE_HALT_CTRL1_ADDR A:0x1c0e004
y.create.l HWIO_PCNOC_0_ABT_HW_VERSION_ADDR A:0x23000
y.create.l HWIO_PCNOC_0_ABT_INST_ID_ADDR A:0x23004
y.create.l HWIO_PCNOC_0_ABT_NUM_SLAVES_ADDR A:0x23008
y.create.l HWIO_PCNOC_0_ABT_TIMER_LOADVAL_ADDR A:0x2300c
y.create.l HWIO_PCNOC_0_ABT_TIMER_MODE_ADDR A:0x23010
y.create.l HWIO_PCNOC_0_ABT_INTR_STATUS_ADDR A:0x23014
y.create.l HWIO_PCNOC_0_ABT_INTR_CLEAR_ADDR A:0x23018
y.create.l HWIO_PCNOC_0_ABT_INTR_ENABLE_ADDR A:0x2301c
y.create.l HWIO_PCNOC_0_ABT_SYND_VALID_ADDR A:0x23020
y.create.l HWIO_PCNOC_0_ABT_SYND_CLEAR_ADDR A:0x23024
y.create.l HWIO_PCNOC_0_ABT_SYND_ID_ADDR A:0x23028
y.create.l HWIO_PCNOC_0_ABT_SYND_ADDR0_ADDR A:0x2302c
y.create.l HWIO_PCNOC_0_ABT_SYND_ADDR1_ADDR A:0x23030
y.create.l HWIO_PCNOC_0_ABT_SYND_HREADY_ADDR A:0x23034
y.create.l HWIO_PCNOC_1_ABT_HW_VERSION_ADDR A:0x24000
y.create.l HWIO_PCNOC_1_ABT_INST_ID_ADDR A:0x24004
y.create.l HWIO_PCNOC_1_ABT_NUM_SLAVES_ADDR A:0x24008
y.create.l HWIO_PCNOC_1_ABT_TIMER_LOADVAL_ADDR A:0x2400c
y.create.l HWIO_PCNOC_1_ABT_TIMER_MODE_ADDR A:0x24010
y.create.l HWIO_PCNOC_1_ABT_INTR_STATUS_ADDR A:0x24014
y.create.l HWIO_PCNOC_1_ABT_INTR_CLEAR_ADDR A:0x24018
y.create.l HWIO_PCNOC_1_ABT_INTR_ENABLE_ADDR A:0x2401c
y.create.l HWIO_PCNOC_1_ABT_SYND_VALID_ADDR A:0x24020
y.create.l HWIO_PCNOC_1_ABT_SYND_CLEAR_ADDR A:0x24024
y.create.l HWIO_PCNOC_1_ABT_SYND_ID_ADDR A:0x24028
y.create.l HWIO_PCNOC_1_ABT_SYND_ADDR0_ADDR A:0x2402c
y.create.l HWIO_PCNOC_1_ABT_SYND_ADDR1_ADDR A:0x24030
y.create.l HWIO_PCNOC_1_ABT_SYND_HREADY_ADDR A:0x24034
y.create.l HWIO_PCNOC_2_ABT_HW_VERSION_ADDR A:0x25000
y.create.l HWIO_PCNOC_2_ABT_INST_ID_ADDR A:0x25004
y.create.l HWIO_PCNOC_2_ABT_NUM_SLAVES_ADDR A:0x25008
y.create.l HWIO_PCNOC_2_ABT_TIMER_LOADVAL_ADDR A:0x2500c
y.create.l HWIO_PCNOC_2_ABT_TIMER_MODE_ADDR A:0x25010
y.create.l HWIO_PCNOC_2_ABT_INTR_STATUS_ADDR A:0x25014
y.create.l HWIO_PCNOC_2_ABT_INTR_CLEAR_ADDR A:0x25018
y.create.l HWIO_PCNOC_2_ABT_INTR_ENABLE_ADDR A:0x2501c
y.create.l HWIO_PCNOC_2_ABT_SYND_VALID_ADDR A:0x25020
y.create.l HWIO_PCNOC_2_ABT_SYND_CLEAR_ADDR A:0x25024
y.create.l HWIO_PCNOC_2_ABT_SYND_ID_ADDR A:0x25028
y.create.l HWIO_PCNOC_2_ABT_SYND_ADDR0_ADDR A:0x2502c
y.create.l HWIO_PCNOC_2_ABT_SYND_ADDR1_ADDR A:0x25030
y.create.l HWIO_PCNOC_2_ABT_SYND_HREADY_ADDR A:0x25034
y.create.l HWIO_PCNOC_3_ABT_HW_VERSION_ADDR A:0x26000
y.create.l HWIO_PCNOC_3_ABT_INST_ID_ADDR A:0x26004
y.create.l HWIO_PCNOC_3_ABT_NUM_SLAVES_ADDR A:0x26008
y.create.l HWIO_PCNOC_3_ABT_TIMER_LOADVAL_ADDR A:0x2600c
y.create.l HWIO_PCNOC_3_ABT_TIMER_MODE_ADDR A:0x26010
y.create.l HWIO_PCNOC_3_ABT_INTR_STATUS_ADDR A:0x26014
y.create.l HWIO_PCNOC_3_ABT_INTR_CLEAR_ADDR A:0x26018
y.create.l HWIO_PCNOC_3_ABT_INTR_ENABLE_ADDR A:0x2601c
y.create.l HWIO_PCNOC_3_ABT_SYND_VALID_ADDR A:0x26020
y.create.l HWIO_PCNOC_3_ABT_SYND_CLEAR_ADDR A:0x26024
y.create.l HWIO_PCNOC_3_ABT_SYND_ID_ADDR A:0x26028
y.create.l HWIO_PCNOC_3_ABT_SYND_ADDR0_ADDR A:0x2602c
y.create.l HWIO_PCNOC_3_ABT_SYND_ADDR1_ADDR A:0x26030
y.create.l HWIO_PCNOC_3_ABT_SYND_HREADY_ADDR A:0x26034
y.create.l HWIO_PCNOC_4_ABT_HW_VERSION_ADDR A:0x27000
y.create.l HWIO_PCNOC_4_ABT_INST_ID_ADDR A:0x27004
y.create.l HWIO_PCNOC_4_ABT_NUM_SLAVES_ADDR A:0x27008
y.create.l HWIO_PCNOC_4_ABT_TIMER_LOADVAL_ADDR A:0x2700c
y.create.l HWIO_PCNOC_4_ABT_TIMER_MODE_ADDR A:0x27010
y.create.l HWIO_PCNOC_4_ABT_INTR_STATUS_ADDR A:0x27014
y.create.l HWIO_PCNOC_4_ABT_INTR_CLEAR_ADDR A:0x27018
y.create.l HWIO_PCNOC_4_ABT_INTR_ENABLE_ADDR A:0x2701c
y.create.l HWIO_PCNOC_4_ABT_SYND_VALID_ADDR A:0x27020
y.create.l HWIO_PCNOC_4_ABT_SYND_CLEAR_ADDR A:0x27024
y.create.l HWIO_PCNOC_4_ABT_SYND_ID_ADDR A:0x27028
y.create.l HWIO_PCNOC_4_ABT_SYND_ADDR0_ADDR A:0x2702c
y.create.l HWIO_PCNOC_4_ABT_SYND_ADDR1_ADDR A:0x27030
y.create.l HWIO_PCNOC_4_ABT_SYND_HREADY_ADDR A:0x27034
y.create.l HWIO_PCNOC_5_ABT_HW_VERSION_ADDR A:0x28000
y.create.l HWIO_PCNOC_5_ABT_INST_ID_ADDR A:0x28004
y.create.l HWIO_PCNOC_5_ABT_NUM_SLAVES_ADDR A:0x28008
y.create.l HWIO_PCNOC_5_ABT_TIMER_LOADVAL_ADDR A:0x2800c
y.create.l HWIO_PCNOC_5_ABT_TIMER_MODE_ADDR A:0x28010
y.create.l HWIO_PCNOC_5_ABT_INTR_STATUS_ADDR A:0x28014
y.create.l HWIO_PCNOC_5_ABT_INTR_CLEAR_ADDR A:0x28018
y.create.l HWIO_PCNOC_5_ABT_INTR_ENABLE_ADDR A:0x2801c
y.create.l HWIO_PCNOC_5_ABT_SYND_VALID_ADDR A:0x28020
y.create.l HWIO_PCNOC_5_ABT_SYND_CLEAR_ADDR A:0x28024
y.create.l HWIO_PCNOC_5_ABT_SYND_ID_ADDR A:0x28028
y.create.l HWIO_PCNOC_5_ABT_SYND_ADDR0_ADDR A:0x2802c
y.create.l HWIO_PCNOC_5_ABT_SYND_ADDR1_ADDR A:0x28030
y.create.l HWIO_PCNOC_5_ABT_SYND_HREADY_ADDR A:0x28034
y.create.l HWIO_PCNOC_6_ABT_HW_VERSION_ADDR A:0x29000
y.create.l HWIO_PCNOC_6_ABT_INST_ID_ADDR A:0x29004
y.create.l HWIO_PCNOC_6_ABT_NUM_SLAVES_ADDR A:0x29008
y.create.l HWIO_PCNOC_6_ABT_TIMER_LOADVAL_ADDR A:0x2900c
y.create.l HWIO_PCNOC_6_ABT_TIMER_MODE_ADDR A:0x29010
y.create.l HWIO_PCNOC_6_ABT_INTR_STATUS_ADDR A:0x29014
y.create.l HWIO_PCNOC_6_ABT_INTR_CLEAR_ADDR A:0x29018
y.create.l HWIO_PCNOC_6_ABT_INTR_ENABLE_ADDR A:0x2901c
y.create.l HWIO_PCNOC_6_ABT_SYND_VALID_ADDR A:0x29020
y.create.l HWIO_PCNOC_6_ABT_SYND_CLEAR_ADDR A:0x29024
y.create.l HWIO_PCNOC_6_ABT_SYND_ID_ADDR A:0x29028
y.create.l HWIO_PCNOC_6_ABT_SYND_ADDR0_ADDR A:0x2902c
y.create.l HWIO_PCNOC_6_ABT_SYND_ADDR1_ADDR A:0x29030
y.create.l HWIO_PCNOC_6_ABT_SYND_HREADY_ADDR A:0x29034
y.create.l HWIO_PCNOC_7_ABT_HW_VERSION_ADDR A:0x2a000
y.create.l HWIO_PCNOC_7_ABT_INST_ID_ADDR A:0x2a004
y.create.l HWIO_PCNOC_7_ABT_NUM_SLAVES_ADDR A:0x2a008
y.create.l HWIO_PCNOC_7_ABT_TIMER_LOADVAL_ADDR A:0x2a00c
y.create.l HWIO_PCNOC_7_ABT_TIMER_MODE_ADDR A:0x2a010
y.create.l HWIO_PCNOC_7_ABT_INTR_STATUS_ADDR A:0x2a014
y.create.l HWIO_PCNOC_7_ABT_INTR_CLEAR_ADDR A:0x2a018
y.create.l HWIO_PCNOC_7_ABT_INTR_ENABLE_ADDR A:0x2a01c
y.create.l HWIO_PCNOC_7_ABT_SYND_VALID_ADDR A:0x2a020
y.create.l HWIO_PCNOC_7_ABT_SYND_CLEAR_ADDR A:0x2a024
y.create.l HWIO_PCNOC_7_ABT_SYND_ID_ADDR A:0x2a028
y.create.l HWIO_PCNOC_7_ABT_SYND_ADDR0_ADDR A:0x2a02c
y.create.l HWIO_PCNOC_7_ABT_SYND_ADDR1_ADDR A:0x2a030
y.create.l HWIO_PCNOC_7_ABT_SYND_HREADY_ADDR A:0x2a034
y.create.l HWIO_PCNOC_OBS_ID_COREID_ADDR A:0x500000
y.create.l HWIO_PCNOC_OBS_ID_REVISIONID_ADDR A:0x500004
y.create.l HWIO_PCNOC_OBS_FAULTEN_ADDR A:0x500008
y.create.l HWIO_PCNOC_OBS_ERRVLD_ADDR A:0x50000c
y.create.l HWIO_PCNOC_OBS_ERRCLR_ADDR A:0x500010
y.create.l HWIO_PCNOC_OBS_ERRLOG0_ADDR A:0x500014
y.create.l HWIO_PCNOC_OBS_ERRLOG1_ADDR A:0x500018
y.create.l HWIO_PCNOC_OBS_ERRLOG3_ADDR A:0x500020
y.create.l HWIO_PCNOC_OBS_ERRLOG4_ADDR A:0x500024
y.create.l HWIO_PCNOC_OBS_ERRLOG5_ADDR A:0x500028
y.create.l HWIO_PCNOC_OBS_DBG_ID_COREID_ADDR A:0x500080
y.create.l HWIO_PCNOC_OBS_DBG_ID_REVISIONID_ADDR A:0x500084
y.create.l HWIO_PCNOC_OBS_DBG_ATBID_ADDR A:0x500088
y.create.l HWIO_PCNOC_OBS_DBG_ATBEN_ADDR A:0x50008c
y.create.l HWIO_PCNOC_OBS_DBG_SYNCPERIOD_ADDR A:0x500090
y.create.l HWIO_PCNOC_QXM_CRYPTO0_TFILT_ID_COREID_ADDR A:0x501000
y.create.l HWIO_PCNOC_QXM_CRYPTO0_TFILT_ID_REVISIONID_ADDR A:0x501004
y.create.l HWIO_PCNOC_QXM_CRYPTO0_TFILT_MODE_ADDR A:0x501008
y.create.l HWIO_PCNOC_QXM_CRYPTO0_TFILT_ADDRBASE_LOW_ADDR A:0x50100c
y.create.l HWIO_PCNOC_QXM_CRYPTO0_TFILT_ADDRBASE_HIGH_ADDR A:0x501010
y.create.l HWIO_PCNOC_QXM_CRYPTO0_TFILT_ADDRWINDOWSIZE_ADDR A:0x501014
y.create.l HWIO_PCNOC_QXM_CRYPTO0_TFILT_SRCIDBASE_ADDR A:0x501018
y.create.l HWIO_PCNOC_QXM_CRYPTO0_TFILT_SRCIDMASK_ADDR A:0x50101c
y.create.l HWIO_PCNOC_QXM_CRYPTO0_TFILT_OPCODE_ADDR A:0x501020
y.create.l HWIO_PCNOC_QXM_CRYPTO0_TFILT_USERBASE_ADDR A:0x501024
y.create.l HWIO_PCNOC_QXM_CRYPTO0_TFILT_USERMASK_ADDR A:0x501028
y.create.l HWIO_PCNOC_QXM_SDC1_TFILT_ID_COREID_ADDR A:0x501080
y.create.l HWIO_PCNOC_QXM_SDC1_TFILT_ID_REVISIONID_ADDR A:0x501084
y.create.l HWIO_PCNOC_QXM_SDC1_TFILT_MODE_ADDR A:0x501088
y.create.l HWIO_PCNOC_QXM_SDC1_TFILT_ADDRBASE_LOW_ADDR A:0x50108c
y.create.l HWIO_PCNOC_QXM_SDC1_TFILT_ADDRBASE_HIGH_ADDR A:0x501090
y.create.l HWIO_PCNOC_QXM_SDC1_TFILT_ADDRWINDOWSIZE_ADDR A:0x501094
y.create.l HWIO_PCNOC_QXM_SDC1_TFILT_SRCIDBASE_ADDR A:0x501098
y.create.l HWIO_PCNOC_QXM_SDC1_TFILT_SRCIDMASK_ADDR A:0x50109c
y.create.l HWIO_PCNOC_QXM_SDC1_TFILT_OPCODE_ADDR A:0x5010a0
y.create.l HWIO_PCNOC_QXM_SDC1_TFILT_USERBASE_ADDR A:0x5010a4
y.create.l HWIO_PCNOC_QXM_SDC1_TFILT_USERMASK_ADDR A:0x5010a8
y.create.l HWIO_PCNOC_QXM_SDC2_TFILT_ID_COREID_ADDR A:0x501100
y.create.l HWIO_PCNOC_QXM_SDC2_TFILT_ID_REVISIONID_ADDR A:0x501104
y.create.l HWIO_PCNOC_QXM_SDC2_TFILT_MODE_ADDR A:0x501108
y.create.l HWIO_PCNOC_QXM_SDC2_TFILT_ADDRBASE_LOW_ADDR A:0x50110c
y.create.l HWIO_PCNOC_QXM_SDC2_TFILT_ADDRBASE_HIGH_ADDR A:0x501110
y.create.l HWIO_PCNOC_QXM_SDC2_TFILT_ADDRWINDOWSIZE_ADDR A:0x501114
y.create.l HWIO_PCNOC_QXM_SDC2_TFILT_SRCIDBASE_ADDR A:0x501118
y.create.l HWIO_PCNOC_QXM_SDC2_TFILT_SRCIDMASK_ADDR A:0x50111c
y.create.l HWIO_PCNOC_QXM_SDC2_TFILT_OPCODE_ADDR A:0x501120
y.create.l HWIO_PCNOC_QXM_SDC2_TFILT_USERBASE_ADDR A:0x501124
y.create.l HWIO_PCNOC_QXM_SDC2_TFILT_USERMASK_ADDR A:0x501128
y.create.l HWIO_PCNOC_QHM2_TFILT_ID_COREID_ADDR A:0x501180
y.create.l HWIO_PCNOC_QHM2_TFILT_ID_REVISIONID_ADDR A:0x501184
y.create.l HWIO_PCNOC_QHM2_TFILT_MODE_ADDR A:0x501188
y.create.l HWIO_PCNOC_QHM2_TFILT_ADDRBASE_LOW_ADDR A:0x50118c
y.create.l HWIO_PCNOC_QHM2_TFILT_ADDRWINDOWSIZE_ADDR A:0x501194
y.create.l HWIO_PCNOC_QHM2_TFILT_SRCIDBASE_ADDR A:0x501198
y.create.l HWIO_PCNOC_QHM2_TFILT_SRCIDMASK_ADDR A:0x50119c
y.create.l HWIO_PCNOC_QHM2_TFILT_OPCODE_ADDR A:0x5011a0
y.create.l HWIO_PCNOC_QHM2_TFILT_USERBASE_ADDR A:0x5011a4
y.create.l HWIO_PCNOC_QHM2_TFILT_USERMASK_ADDR A:0x5011a8
y.create.l HWIO_PCNOC_QHM1_TFILT_ID_COREID_ADDR A:0x501200
y.create.l HWIO_PCNOC_QHM1_TFILT_ID_REVISIONID_ADDR A:0x501204
y.create.l HWIO_PCNOC_QHM1_TFILT_MODE_ADDR A:0x501208
y.create.l HWIO_PCNOC_QHM1_TFILT_ADDRBASE_LOW_ADDR A:0x50120c
y.create.l HWIO_PCNOC_QHM1_TFILT_ADDRWINDOWSIZE_ADDR A:0x501214
y.create.l HWIO_PCNOC_QHM1_TFILT_SRCIDBASE_ADDR A:0x501218
y.create.l HWIO_PCNOC_QHM1_TFILT_SRCIDMASK_ADDR A:0x50121c
y.create.l HWIO_PCNOC_QHM1_TFILT_OPCODE_ADDR A:0x501220
y.create.l HWIO_PCNOC_QHM1_TFILT_USERBASE_ADDR A:0x501224
y.create.l HWIO_PCNOC_QHM1_TFILT_USERMASK_ADDR A:0x501228
y.create.l HWIO_PCNOC_QXM_SNOC_TFILT_ID_COREID_ADDR A:0x501280
y.create.l HWIO_PCNOC_QXM_SNOC_TFILT_ID_REVISIONID_ADDR A:0x501284
y.create.l HWIO_PCNOC_QXM_SNOC_TFILT_MODE_ADDR A:0x501288
y.create.l HWIO_PCNOC_QXM_SNOC_TFILT_ADDRBASE_LOW_ADDR A:0x50128c
y.create.l HWIO_PCNOC_QXM_SNOC_TFILT_ADDRBASE_HIGH_ADDR A:0x501290
y.create.l HWIO_PCNOC_QXM_SNOC_TFILT_ADDRWINDOWSIZE_ADDR A:0x501294
y.create.l HWIO_PCNOC_QXM_SNOC_TFILT_SRCIDBASE_ADDR A:0x501298
y.create.l HWIO_PCNOC_QXM_SNOC_TFILT_SRCIDMASK_ADDR A:0x50129c
y.create.l HWIO_PCNOC_QXM_SNOC_TFILT_OPCODE_ADDR A:0x5012a0
y.create.l HWIO_PCNOC_QXM_SNOC_TFILT_USERBASE_ADDR A:0x5012a4
y.create.l HWIO_PCNOC_QXM_SNOC_TFILT_USERMASK_ADDR A:0x5012a8
y.create.l HWIO_PCNOC_TPRB0_TPROF_ID_COREID_ADDR A:0x502000
y.create.l HWIO_PCNOC_TPRB0_TPROF_ID_REVISIONID_ADDR A:0x502004
y.create.l HWIO_PCNOC_TPRB0_TPROF_EN_ADDR A:0x502008
y.create.l HWIO_PCNOC_TPRB0_TPROF_MODE_ADDR A:0x50200c
y.create.l HWIO_PCNOC_TPRB0_TPROF_OBSERVEDSEL_0_ADDR A:0x502010
y.create.l HWIO_PCNOC_TPRB0_TPROF_OBSERVEDSEL_1_ADDR A:0x502014
y.create.l HWIO_PCNOC_TPRB0_TPROF_NTENURELINES_0_ADDR A:0x502020
y.create.l HWIO_PCNOC_TPRB0_TPROF_THRESHOLDS_0_0_ADDR A:0x50202c
y.create.l HWIO_PCNOC_TPRB0_TPROF_THRESHOLDS_0_1_ADDR A:0x502030
y.create.l HWIO_PCNOC_TPRB0_TPROF_THRESHOLDS_0_2_ADDR A:0x502034
y.create.l HWIO_PCNOC_TPRB0_TPROF_THRESHOLDS_1_0_ADDR A:0x50203c
y.create.l HWIO_PCNOC_TPRB0_TPROF_THRESHOLDS_1_1_ADDR A:0x502040
y.create.l HWIO_PCNOC_TPRB0_TPROF_THRESHOLDS_1_2_ADDR A:0x502044
y.create.l HWIO_PCNOC_TPRB0_TPROF_OVERFLOWSTATUS_ADDR A:0x50206c
y.create.l HWIO_PCNOC_TPRB0_TPROF_OVERFLOWRESET_ADDR A:0x502070
y.create.l HWIO_PCNOC_TPRB0_TPROF_PENDINGEVENTMODE_ADDR A:0x502074
y.create.l HWIO_PCNOC_TPRB0_TPROF_PRESCALER_ADDR A:0x502078
y.create.l HWIO_PCNOC_EPRB0_SPROF_ID_COREID_ADDR A:0x503000
y.create.l HWIO_PCNOC_EPRB0_SPROF_ID_REVISIONID_ADDR A:0x503004
y.create.l HWIO_PCNOC_EPRB0_SPROF_MAINCTL_ADDR A:0x503008
y.create.l HWIO_PCNOC_EPRB0_SPROF_CFGCTL_ADDR A:0x50300c
y.create.l HWIO_PCNOC_EPRB0_SPROF_FILTERLUT_ADDR A:0x503014
y.create.l HWIO_PCNOC_EPRB0_SPROF_TRACEALARMEN_ADDR A:0x503018
y.create.l HWIO_PCNOC_EPRB0_SPROF_TRACEALARMSTATUS_ADDR A:0x50301c
y.create.l HWIO_PCNOC_EPRB0_SPROF_TRACEALARMCLR_ADDR A:0x503020
y.create.l HWIO_PCNOC_EPRB0_SPROF_STATPERIOD_ADDR A:0x503024
y.create.l HWIO_PCNOC_EPRB0_SPROF_STATGO_ADDR A:0x503028
y.create.l HWIO_PCNOC_EPRB0_SPROF_STATALARMMIN_ADDR A:0x50302c
y.create.l HWIO_PCNOC_EPRB0_SPROF_STATALARMMAX_ADDR A:0x503030
y.create.l HWIO_PCNOC_EPRB0_SPROF_STATALARMSTATUS_ADDR A:0x503034
y.create.l HWIO_PCNOC_EPRB0_SPROF_STATALARMCLR_ADDR A:0x503038
y.create.l HWIO_PCNOC_EPRB0_SPROF_STATALARMEN_ADDR A:0x50303c
y.create.l HWIO_PCNOC_EPRB0_SPROF_FILTERS_0_ROUTEIDBASE_ADDR A:0x503044
y.create.l HWIO_PCNOC_EPRB0_SPROF_FILTERS_0_ROUTEIDMASK_ADDR A:0x503048
y.create.l HWIO_PCNOC_EPRB0_SPROF_FILTERS_0_ADDRBASE_LOW_ADDR A:0x50304c
y.create.l HWIO_PCNOC_EPRB0_SPROF_FILTERS_0_ADDRBASE_HIGH_ADDR A:0x503050
y.create.l HWIO_PCNOC_EPRB0_SPROF_FILTERS_0_WINDOWSIZE_ADDR A:0x503054
y.create.l HWIO_PCNOC_EPRB0_SPROF_FILTERS_0_OPCODE_ADDR A:0x503060
y.create.l HWIO_PCNOC_EPRB0_SPROF_FILTERS_0_STATUS_ADDR A:0x503064
y.create.l HWIO_PCNOC_EPRB0_SPROF_FILTERS_0_LENGTH_ADDR A:0x503068
y.create.l HWIO_PCNOC_EPRB0_SPROF_FILTERS_0_URGENCY_ADDR A:0x50306c
y.create.l HWIO_PCNOC_EPRB0_SPROF_FILTERS_1_ROUTEIDBASE_ADDR A:0x503080
y.create.l HWIO_PCNOC_EPRB0_SPROF_FILTERS_1_ROUTEIDMASK_ADDR A:0x503084
y.create.l HWIO_PCNOC_EPRB0_SPROF_FILTERS_1_ADDRBASE_LOW_ADDR A:0x503088
y.create.l HWIO_PCNOC_EPRB0_SPROF_FILTERS_1_ADDRBASE_HIGH_ADDR A:0x50308c
y.create.l HWIO_PCNOC_EPRB0_SPROF_FILTERS_1_WINDOWSIZE_ADDR A:0x503090
y.create.l HWIO_PCNOC_EPRB0_SPROF_FILTERS_1_OPCODE_ADDR A:0x50309c
y.create.l HWIO_PCNOC_EPRB0_SPROF_FILTERS_1_STATUS_ADDR A:0x5030a0
y.create.l HWIO_PCNOC_EPRB0_SPROF_FILTERS_1_LENGTH_ADDR A:0x5030a4
y.create.l HWIO_PCNOC_EPRB0_SPROF_FILTERS_1_URGENCY_ADDR A:0x5030a8
y.create.l HWIO_PCNOC_EPRB0_SPROF_COUNTERS_0_SRC_ADDR A:0x503138
y.create.l HWIO_PCNOC_EPRB0_SPROF_COUNTERS_0_ALARMMODE_ADDR A:0x50313c
y.create.l HWIO_PCNOC_EPRB0_SPROF_COUNTERS_0_VAL_ADDR A:0x503140
y.create.l HWIO_PCNOC_EPRB0_SPROF_COUNTERS_1_SRC_ADDR A:0x50314c
y.create.l HWIO_PCNOC_EPRB0_SPROF_COUNTERS_1_ALARMMODE_ADDR A:0x503150
y.create.l HWIO_PCNOC_EPRB0_SPROF_COUNTERS_1_VAL_ADDR A:0x503154
y.create.l HWIO_PCNOC_EPRB0_SPROF_COUNTERS_2_SRC_ADDR A:0x503160
y.create.l HWIO_PCNOC_EPRB0_SPROF_COUNTERS_2_ALARMMODE_ADDR A:0x503164
y.create.l HWIO_PCNOC_EPRB0_SPROF_COUNTERS_2_VAL_ADDR A:0x503168
y.create.l HWIO_PCNOC_EPRB0_SPROF_COUNTERS_3_SRC_ADDR A:0x503174
y.create.l HWIO_PCNOC_EPRB0_SPROF_COUNTERS_3_ALARMMODE_ADDR A:0x503178
y.create.l HWIO_PCNOC_EPRB0_SPROF_COUNTERS_3_VAL_ADDR A:0x50317c
y.create.l HWIO_PCNOC_EPRB0_SPROF_COUNTERS_4_SRC_ADDR A:0x503188
y.create.l HWIO_PCNOC_EPRB0_SPROF_COUNTERS_4_ALARMMODE_ADDR A:0x50318c
y.create.l HWIO_PCNOC_EPRB0_SPROF_COUNTERS_4_VAL_ADDR A:0x503190
y.create.l HWIO_PCNOC_EPRB0_SPROF_COUNTERS_5_SRC_ADDR A:0x50319c
y.create.l HWIO_PCNOC_EPRB0_SPROF_COUNTERS_5_ALARMMODE_ADDR A:0x5031a0
y.create.l HWIO_PCNOC_EPRB0_SPROF_COUNTERS_5_VAL_ADDR A:0x5031a4
y.create.l HWIO_PCNOC_EPRB0_SPROF_COUNTERS_6_SRC_ADDR A:0x5031b0
y.create.l HWIO_PCNOC_EPRB0_SPROF_COUNTERS_6_ALARMMODE_ADDR A:0x5031b4
y.create.l HWIO_PCNOC_EPRB0_SPROF_COUNTERS_6_VAL_ADDR A:0x5031b8
y.create.l HWIO_PCNOC_EPRB0_SPROF_COUNTERS_7_SRC_ADDR A:0x5031c4
y.create.l HWIO_PCNOC_EPRB0_SPROF_COUNTERS_7_ALARMMODE_ADDR A:0x5031c8
y.create.l HWIO_PCNOC_EPRB0_SPROF_COUNTERS_7_VAL_ADDR A:0x5031cc
y.create.l HWIO_PCNOC_TPRB0_SPROF_ID_COREID_ADDR A:0x504000
y.create.l HWIO_PCNOC_TPRB0_SPROF_ID_REVISIONID_ADDR A:0x504004
y.create.l HWIO_PCNOC_TPRB0_SPROF_MAINCTL_ADDR A:0x504008
y.create.l HWIO_PCNOC_TPRB0_SPROF_CFGCTL_ADDR A:0x50400c
y.create.l HWIO_PCNOC_TPRB0_SPROF_STATPERIOD_ADDR A:0x504024
y.create.l HWIO_PCNOC_TPRB0_SPROF_STATGO_ADDR A:0x504028
y.create.l HWIO_PCNOC_TPRB0_SPROF_STATALARMMIN_ADDR A:0x50402c
y.create.l HWIO_PCNOC_TPRB0_SPROF_STATALARMMAX_ADDR A:0x504030
y.create.l HWIO_PCNOC_TPRB0_SPROF_STATALARMSTATUS_ADDR A:0x504034
y.create.l HWIO_PCNOC_TPRB0_SPROF_STATALARMCLR_ADDR A:0x504038
y.create.l HWIO_PCNOC_TPRB0_SPROF_STATALARMEN_ADDR A:0x50403c
y.create.l HWIO_PCNOC_TPRB0_SPROF_COUNTERS_0_SRC_ADDR A:0x504138
y.create.l HWIO_PCNOC_TPRB0_SPROF_COUNTERS_0_ALARMMODE_ADDR A:0x50413c
y.create.l HWIO_PCNOC_TPRB0_SPROF_COUNTERS_0_VAL_ADDR A:0x504140
y.create.l HWIO_PCNOC_TPRB0_SPROF_COUNTERS_1_SRC_ADDR A:0x50414c
y.create.l HWIO_PCNOC_TPRB0_SPROF_COUNTERS_1_ALARMMODE_ADDR A:0x504150
y.create.l HWIO_PCNOC_TPRB0_SPROF_COUNTERS_1_VAL_ADDR A:0x504154
y.create.l HWIO_PCNOC_TPRB0_SPROF_COUNTERS_2_SRC_ADDR A:0x504160
y.create.l HWIO_PCNOC_TPRB0_SPROF_COUNTERS_2_ALARMMODE_ADDR A:0x504164
y.create.l HWIO_PCNOC_TPRB0_SPROF_COUNTERS_2_VAL_ADDR A:0x504168
y.create.l HWIO_PCNOC_TPRB0_SPROF_COUNTERS_3_SRC_ADDR A:0x504174
y.create.l HWIO_PCNOC_TPRB0_SPROF_COUNTERS_3_ALARMMODE_ADDR A:0x504178
y.create.l HWIO_PCNOC_TPRB0_SPROF_COUNTERS_3_VAL_ADDR A:0x50417c
y.create.l HWIO_PCNOC_TPRB0_SPROF_COUNTERS_4_SRC_ADDR A:0x504188
y.create.l HWIO_PCNOC_TPRB0_SPROF_COUNTERS_4_ALARMMODE_ADDR A:0x50418c
y.create.l HWIO_PCNOC_TPRB0_SPROF_COUNTERS_4_VAL_ADDR A:0x504190
y.create.l HWIO_PCNOC_TPRB0_SPROF_COUNTERS_5_SRC_ADDR A:0x50419c
y.create.l HWIO_PCNOC_TPRB0_SPROF_COUNTERS_5_ALARMMODE_ADDR A:0x5041a0
y.create.l HWIO_PCNOC_TPRB0_SPROF_COUNTERS_5_VAL_ADDR A:0x5041a4
y.create.l HWIO_PCNOC_TPRB0_SPROF_COUNTERS_6_SRC_ADDR A:0x5041b0
y.create.l HWIO_PCNOC_TPRB0_SPROF_COUNTERS_6_ALARMMODE_ADDR A:0x5041b4
y.create.l HWIO_PCNOC_TPRB0_SPROF_COUNTERS_6_VAL_ADDR A:0x5041b8
y.create.l HWIO_PCNOC_TPRB0_SPROF_COUNTERS_7_SRC_ADDR A:0x5041c4
y.create.l HWIO_PCNOC_TPRB0_SPROF_COUNTERS_7_ALARMMODE_ADDR A:0x5041c8
y.create.l HWIO_PCNOC_TPRB0_SPROF_COUNTERS_7_VAL_ADDR A:0x5041cc
y.create.l HWIO_PCNOC_TPRB0_SPROF_COUNTERS_8_SRC_ADDR A:0x5041d8
y.create.l HWIO_PCNOC_TPRB0_SPROF_COUNTERS_8_ALARMMODE_ADDR A:0x5041dc
y.create.l HWIO_PCNOC_TPRB0_SPROF_COUNTERS_8_VAL_ADDR A:0x5041e0
y.create.l HWIO_PCNOC_TPRB0_SPROF_COUNTERS_9_SRC_ADDR A:0x5041ec
y.create.l HWIO_PCNOC_TPRB0_SPROF_COUNTERS_9_ALARMMODE_ADDR A:0x5041f0
y.create.l HWIO_PCNOC_TPRB0_SPROF_COUNTERS_9_VAL_ADDR A:0x5041f4
y.create.l HWIO_PCNOC_TPRB0_SPROF_COUNTERS_10_SRC_ADDR A:0x504200
y.create.l HWIO_PCNOC_TPRB0_SPROF_COUNTERS_10_ALARMMODE_ADDR A:0x504204
y.create.l HWIO_PCNOC_TPRB0_SPROF_COUNTERS_10_VAL_ADDR A:0x504208
y.create.l HWIO_PCNOC_TPRB0_SPROF_COUNTERS_11_SRC_ADDR A:0x504214
y.create.l HWIO_PCNOC_TPRB0_SPROF_COUNTERS_11_ALARMMODE_ADDR A:0x504218
y.create.l HWIO_PCNOC_TPRB0_SPROF_COUNTERS_11_VAL_ADDR A:0x50421c
y.create.l HWIO_PCNOC_TPRB0_SPROF_COUNTERS_12_SRC_ADDR A:0x504228
y.create.l HWIO_PCNOC_TPRB0_SPROF_COUNTERS_12_ALARMMODE_ADDR A:0x50422c
y.create.l HWIO_PCNOC_TPRB0_SPROF_COUNTERS_12_VAL_ADDR A:0x504230
y.create.l HWIO_PCNOC_TPRB0_SPROF_COUNTERS_13_SRC_ADDR A:0x50423c
y.create.l HWIO_PCNOC_TPRB0_SPROF_COUNTERS_13_ALARMMODE_ADDR A:0x504240
y.create.l HWIO_PCNOC_TPRB0_SPROF_COUNTERS_13_VAL_ADDR A:0x504244
y.create.l HWIO_PCNOC_TPRB0_SPROF_COUNTERS_14_SRC_ADDR A:0x504250
y.create.l HWIO_PCNOC_TPRB0_SPROF_COUNTERS_14_ALARMMODE_ADDR A:0x504254
y.create.l HWIO_PCNOC_TPRB0_SPROF_COUNTERS_14_VAL_ADDR A:0x504258
y.create.l HWIO_PCNOC_TPRB0_SPROF_COUNTERS_15_SRC_ADDR A:0x504264
y.create.l HWIO_PCNOC_TPRB0_SPROF_COUNTERS_15_ALARMMODE_ADDR A:0x504268
y.create.l HWIO_PCNOC_TPRB0_SPROF_COUNTERS_15_VAL_ADDR A:0x50426c
y.create.l HWIO_PCNOC_CRYPTO0_QOS_ID_COREID_ADDR A:0x507000
y.create.l HWIO_PCNOC_CRYPTO0_QOS_ID_REVISIONID_ADDR A:0x507004
y.create.l HWIO_PCNOC_CRYPTO0_QOS_PRIORITY_ADDR A:0x507008
y.create.l HWIO_PCNOC_CRYPTO0_QOS_MODE_ADDR A:0x50700c
y.create.l HWIO_PCNOC_CRYPTO0_QOS_EXTCONTROL_ADDR A:0x507018
y.create.l HWIO_PCNOC_QHM1_QOS_ID_COREID_ADDR A:0x50c000
y.create.l HWIO_PCNOC_QHM1_QOS_ID_REVISIONID_ADDR A:0x50c004
y.create.l HWIO_PCNOC_QHM1_QOS_PRIORITY_ADDR A:0x50c008
y.create.l HWIO_PCNOC_QHM1_QOS_MODE_ADDR A:0x50c00c
y.create.l HWIO_PCNOC_QHM1_QOS_EXTCONTROL_ADDR A:0x50c018
y.create.l HWIO_PCNOC_QHM2_QOS_ID_COREID_ADDR A:0x50d000
y.create.l HWIO_PCNOC_QHM2_QOS_ID_REVISIONID_ADDR A:0x50d004
y.create.l HWIO_PCNOC_QHM2_QOS_PRIORITY_ADDR A:0x50d008
y.create.l HWIO_PCNOC_QHM2_QOS_MODE_ADDR A:0x50d00c
y.create.l HWIO_PCNOC_QHM2_QOS_EXTCONTROL_ADDR A:0x50d018
y.create.l HWIO_PCNOC_SDC1_QOS_ID_COREID_ADDR A:0x50e000
y.create.l HWIO_PCNOC_SDC1_QOS_ID_REVISIONID_ADDR A:0x50e004
y.create.l HWIO_PCNOC_SDC1_QOS_PRIORITY_ADDR A:0x50e008
y.create.l HWIO_PCNOC_SDC1_QOS_MODE_ADDR A:0x50e00c
y.create.l HWIO_PCNOC_SDC1_QOS_EXTCONTROL_ADDR A:0x50e018
y.create.l HWIO_PCNOC_SDC2_QOS_ID_COREID_ADDR A:0x50f000
y.create.l HWIO_PCNOC_SDC2_QOS_ID_REVISIONID_ADDR A:0x50f004
y.create.l HWIO_PCNOC_SDC2_QOS_PRIORITY_ADDR A:0x50f008
y.create.l HWIO_PCNOC_SDC2_QOS_MODE_ADDR A:0x50f00c
y.create.l HWIO_PCNOC_SDC2_QOS_EXTCONTROL_ADDR A:0x50f018
y.create.l HWIO_PCNOC_SNOC_QOS_ID_COREID_ADDR A:0x510000
y.create.l HWIO_PCNOC_SNOC_QOS_ID_REVISIONID_ADDR A:0x510004
y.create.l HWIO_PCNOC_SNOC_QOS_PRIORITY_ADDR A:0x510008
y.create.l HWIO_PCNOC_SNOC_QOS_MODE_ADDR A:0x51000c
y.create.l HWIO_PCNOC_SNOC_QOS_EXTCONTROL_ADDR A:0x510018
y.create.l HWIO_PDM_TCXO_PDM0_TOP_CTL_ADDR A:0x68000
y.create.l HWIO_PDM_PDM0_CTL_ADDR A:0x68004
y.create.l HWIO_PDM_WEB_TCXO4_TEST_ADDR A:0x68008
y.create.l HWIO_PDM_TCXO_PDM1_TOP_CTL_ADDR A:0x69000
y.create.l HWIO_PDM_PDM1_CTL_ADDR A:0x69004
y.create.l HWIO_PDM_TCXO_PDM2_TOP_CTL_ADDR A:0x6a000
y.create.l HWIO_PDM_PDM2_CTL_ADDR A:0x6a004
y.create.l HWIO_PDM_GP_MN_CLK_MDIV_ADDR A:0x6b000
y.create.l HWIO_PDM_GP_MN_CLK_NDIV_ADDR A:0x6b004
y.create.l HWIO_PDM_GP_MN_CLK_DUTY_ADDR A:0x6b008
y.create.l HWIO_SPMI_GENI_CLK_CTRL_ADDR A:0x200a000
y.create.l HWIO_SPMI_GENI_HW_VERSION_ADDR A:0x200a004
y.create.l HWIO_SPMI_GENI_FW_REVISION_ADDR A:0x200a008
y.create.l HWIO_SPMI_GENI_S_FW_REVISION_ADDR A:0x200a00c
y.create.l HWIO_SPMI_GENI_FORCE_DEFAULT_REG_ADDR A:0x200a010
y.create.l HWIO_SPMI_GENI_OUTPUT_CTRL_ADDR A:0x200a014
y.create.l HWIO_SPMI_GENI_CGC_CTRL_ADDR A:0x200a018
y.create.l HWIO_SPMI_GENI_CHAR_CFG_ADDR A:0x200a01c
y.create.l HWIO_SPMI_GENI_CHAR_DATA_0_ADDR A:0x200a020
y.create.l HWIO_SPMI_GENI_CHAR_DATA_1_ADDR A:0x200a024
y.create.l HWIO_SPMI_GENI_CTRL_ADDR A:0x200a028
y.create.l HWIO_SPMI_GENI_STATUS_ADDR A:0x200a02c
y.create.l HWIO_SPMI_GENI_TEST_BUS_CTRL_ADDR A:0x200a030
y.create.l HWIO_SPMI_GENI_SER_CLK_CFG_ADDR A:0x200a034
y.create.l HWIO_SPMI_GENI_TX_WATERMARK_REG_ADDR A:0x200a038
y.create.l HWIO_SPMI_GENI_RX_WATERMARK_REG_ADDR A:0x200a03c
y.create.l HWIO_SPMI_GENI_STOP_REG_ADDR A:0x200a040
y.create.l HWIO_SPMI_GENI_SW_COMP_REG_ADDR A:0x200a044
y.create.l HWIO_SPMI_GENI_PROG_ROM_CTRL_REG_ADDR A:0x200a048
y.create.l HWIO_SPMI_GENI_CFG_REG0_ADDR A:0x200a100
y.create.l HWIO_SPMI_GENI_CFG_REG1_ADDR A:0x200a104
y.create.l HWIO_SPMI_GENI_CFG_REG2_ADDR A:0x200a108
y.create.l HWIO_SPMI_GENI_CFG_REG3_ADDR A:0x200a10c
y.create.l HWIO_SPMI_GENI_CFG_REG4_ADDR A:0x200a110
y.create.l HWIO_SPMI_GENI_CFG_REG5_ADDR A:0x200a114
y.create.l HWIO_SPMI_GENI_CFG_REG6_ADDR A:0x200a118
y.create.l HWIO_SPMI_GENI_CFG_REG7_ADDR A:0x200a11c
y.create.l HWIO_SPMI_GENI_CFG_REG8_ADDR A:0x200a120
y.create.l HWIO_SPMI_GENI_CFG_REG9_ADDR A:0x200a124
y.create.l HWIO_SPMI_GENI_CFG_REG10_ADDR A:0x200a128
y.create.l HWIO_SPMI_GENI_CFG_REG11_ADDR A:0x200a12c
y.create.l HWIO_SPMI_GENI_CFG_REG12_ADDR A:0x200a130
y.create.l HWIO_SPMI_GENI_CFG_REG13_ADDR A:0x200a134
y.create.l HWIO_SPMI_GENI_CFG_REG14_ADDR A:0x200a138
y.create.l HWIO_SPMI_GENI_CFG_REG15_ADDR A:0x200a13c
y.create.l HWIO_SPMI_GENI_CFG_REG16_ADDR A:0x200a140
y.create.l HWIO_SPMI_GENI_CFG_REG17_ADDR A:0x200a144
y.create.l HWIO_SPMI_GENI_CFG_REG18_ADDR A:0x200a148
y.create.l HWIO_SPMI_GENI_CFG_REG19_ADDR A:0x200a14c
y.create.l HWIO_SPMI_GENI_CFG_REG20_ADDR A:0x200a150
y.create.l HWIO_SPMI_GENI_CFG_REG21_ADDR A:0x200a154
y.create.l HWIO_SPMI_GENI_CFG_REG22_ADDR A:0x200a158
y.create.l HWIO_SPMI_GENI_CFG_REG23_ADDR A:0x200a15c
y.create.l HWIO_SPMI_GENI_CFG_REG24_ADDR A:0x200a160
y.create.l HWIO_SPMI_GENI_CFG_REG25_ADDR A:0x200a164
y.create.l HWIO_SPMI_GENI_CFG_REG26_ADDR A:0x200a168
y.create.l HWIO_SPMI_GENI_CFG_REG27_ADDR A:0x200a16c
y.create.l HWIO_SPMI_GENI_CFG_REG28_ADDR A:0x200a170
y.create.l HWIO_SPMI_GENI_CFG_REG29_ADDR A:0x200a174
y.create.l HWIO_SPMI_GENI_CFG_REG30_ADDR A:0x200a178
y.create.l HWIO_SPMI_GENI_CFG_RAM0_ADDR A:0x200a200
y.create.l HWIO_SPMI_GENI_CFG_RAM1_ADDR A:0x200a204
y.create.l HWIO_SPMI_GENI_CFG_RAM2_ADDR A:0x200a208
y.create.l HWIO_SPMI_GENI_CFG_RAM3_ADDR A:0x200a20c
y.create.l HWIO_SPMI_GENI_CFG_RAM4_ADDR A:0x200a210
y.create.l HWIO_SPMI_GENI_CFG_RAM5_ADDR A:0x200a214
y.create.l HWIO_SPMI_GENI_CFG_RAM6_ADDR A:0x200a218
y.create.l HWIO_SPMI_GENI_CFG_RAM7_ADDR A:0x200a21c
y.create.l HWIO_SPMI_GENI_CFG_RAM8_ADDR A:0x200a220
y.create.l HWIO_SPMI_GENI_CFG_RAM9_ADDR A:0x200a224
y.create.l HWIO_SPMI_PERIPH0_2OWNER_TABLE_REG_ADDR A:0x200a700
y.create.l HWIO_SPMI_PERIPH1_2OWNER_TABLE_REG_ADDR A:0x200a704
y.create.l HWIO_SPMI_PERIPH2_2OWNER_TABLE_REG_ADDR A:0x200a708
y.create.l HWIO_SPMI_PERIPH3_2OWNER_TABLE_REG_ADDR A:0x200a70c
y.create.l HWIO_SPMI_PERIPH4_2OWNER_TABLE_REG_ADDR A:0x200a710
y.create.l HWIO_SPMI_PERIPH5_2OWNER_TABLE_REG_ADDR A:0x200a714
y.create.l HWIO_SPMI_PERIPH6_2OWNER_TABLE_REG_ADDR A:0x200a718
y.create.l HWIO_SPMI_PERIPH7_2OWNER_TABLE_REG_ADDR A:0x200a71c
y.create.l HWIO_SPMI_PERIPH8_2OWNER_TABLE_REG_ADDR A:0x200a720
y.create.l HWIO_SPMI_PERIPH9_2OWNER_TABLE_REG_ADDR A:0x200a724
y.create.l HWIO_SPMI_MAPPING_TABLE_REG0_ADDR A:0x200ab00
y.create.l HWIO_SPMI_MAPPING_TABLE_REG1_ADDR A:0x200ab04
y.create.l HWIO_SPMI_MAPPING_TABLE_REG2_ADDR A:0x200ab08
y.create.l HWIO_SPMI_MAPPING_TABLE_REG3_ADDR A:0x200ab0c
y.create.l HWIO_SPMI_MAPPING_TABLE_REG4_ADDR A:0x200ab10
y.create.l HWIO_SPMI_MAPPING_TABLE_REG5_ADDR A:0x200ab14
y.create.l HWIO_SPMI_MAPPING_TABLE_REG6_ADDR A:0x200ab18
y.create.l HWIO_SPMI_MAPPING_TABLE_REG7_ADDR A:0x200ab1c
y.create.l HWIO_SPMI_MAPPING_TABLE_REG8_ADDR A:0x200ab20
y.create.l HWIO_SPMI_MAPPING_TABLE_REG9_ADDR A:0x200ab24
y.create.l HWIO_SPMI_MID_REG_ADDR A:0x200af00
y.create.l HWIO_SPMI_CFG_REG_ADDR A:0x200af04
y.create.l HWIO_SPMI_SEC_DISABLE_REG_ADDR A:0x200af08
y.create.l HWIO_SPMI_HW_VERSION_ADDR A:0x200af0c
y.create.l HWIO_SPMI_CGC_CTRL_ADDR A:0x200af10
y.create.l HWIO_SPMI_MWB_ENABLE_REG_ADDR A:0x200af14
y.create.l HWIO_SPMI_CHAR_CFG_ADDR A:0x200af40
y.create.l HWIO_SPMI_CHAR_DATA_0_ADDR A:0x200af44
y.create.l HWIO_SPMI_CHAR_DATA_1_ADDR A:0x200af48
y.create.l HWIO_SPMI_CMPR_EN_REG_ADDR A:0x200af54
y.create.l HWIO_SPMI_PROTOCOL_IRQ_STATUS_ADDR A:0x200b000
y.create.l HWIO_SPMI_PROTOCOL_IRQ_ENABLE_ADDR A:0x200b004
y.create.l HWIO_SPMI_PROTOCOL_IRQ_CLEAR_ADDR A:0x200b008
y.create.l HWIO_SPMI_PROTOCOL_IRQ_EN_SET_ADDR A:0x200b00c
y.create.l HWIO_SPMI_PROTOCOL_IRQ_EN_CLEAR_ADDR A:0x200b010
y.create.l HWIO_SPMI_TEST_BUS_CTRL_ADDR A:0x200c000
y.create.l HWIO_SPMI_HW_SW_EVENTS_CTRL_ADDR A:0x200c004
y.create.l HWIO_SPMI_HW_SW_EVENTS_BITWISE_REG0_ADDR A:0x200c008
y.create.l HWIO_SPMI_HW_SW_EVENTS_BITWISE_REG1_ADDR A:0x200c00c
y.create.l HWIO_SPMI_HW_SW_EVENTS_BITWISE_REG2_ADDR A:0x200c010
y.create.l HWIO_SPMI_HW_SW_EVENTS_BITWISE_REG3_ADDR A:0x200c014
y.create.l HWIO_SPMI_HW_SW_EVENTS_BITWISE_REG4_ADDR A:0x200c018
y.create.l HWIO_SPMI_HW_SW_EVENTS_BITWISE_REG5_ADDR A:0x200c01c
y.create.l HWIO_SPMI_HW_SW_EVENTS_BITWISE_REG6_ADDR A:0x200c020
y.create.l HWIO_SPMI_HW_SW_EVENTS_BITWISE_REG7_ADDR A:0x200c024
y.create.l HWIO_SPMI_PIC_OWNER0_ACC_STATUS0_ADDR A:0x3900000
y.create.l HWIO_SPMI_PIC_OWNER0_ACC_STATUS1_ADDR A:0x3900004
y.create.l HWIO_SPMI_PIC_OWNER0_ACC_STATUS2_ADDR A:0x3900008
y.create.l HWIO_SPMI_PIC_OWNER0_ACC_STATUS3_ADDR A:0x390000c
y.create.l HWIO_SPMI_PIC_OWNER1_ACC_STATUS0_ADDR A:0x3901000
y.create.l HWIO_SPMI_PIC_OWNER1_ACC_STATUS1_ADDR A:0x3901004
y.create.l HWIO_SPMI_PIC_OWNER1_ACC_STATUS2_ADDR A:0x3901008
y.create.l HWIO_SPMI_PIC_OWNER1_ACC_STATUS3_ADDR A:0x390100c
y.create.l HWIO_SPMI_PIC_OWNER2_ACC_STATUS0_ADDR A:0x3902000
y.create.l HWIO_SPMI_PIC_OWNER2_ACC_STATUS1_ADDR A:0x3902004
y.create.l HWIO_SPMI_PIC_OWNER2_ACC_STATUS2_ADDR A:0x3902008
y.create.l HWIO_SPMI_PIC_OWNER2_ACC_STATUS3_ADDR A:0x390200c
y.create.l HWIO_SPMI_PIC_OWNER3_ACC_STATUS0_ADDR A:0x3903000
y.create.l HWIO_SPMI_PIC_OWNER3_ACC_STATUS1_ADDR A:0x3903004
y.create.l HWIO_SPMI_PIC_OWNER3_ACC_STATUS2_ADDR A:0x3903008
y.create.l HWIO_SPMI_PIC_OWNER3_ACC_STATUS3_ADDR A:0x390300c
y.create.l HWIO_SPMI_PIC_OWNER4_ACC_STATUS0_ADDR A:0x3904000
y.create.l HWIO_SPMI_PIC_OWNER4_ACC_STATUS1_ADDR A:0x3904004
y.create.l HWIO_SPMI_PIC_OWNER4_ACC_STATUS2_ADDR A:0x3904008
y.create.l HWIO_SPMI_PIC_OWNER4_ACC_STATUS3_ADDR A:0x390400c
y.create.l HWIO_SPMI_PIC_OWNER5_ACC_STATUS0_ADDR A:0x3905000
y.create.l HWIO_SPMI_PIC_OWNER5_ACC_STATUS1_ADDR A:0x3905004
y.create.l HWIO_SPMI_PIC_OWNER5_ACC_STATUS2_ADDR A:0x3905008
y.create.l HWIO_SPMI_PIC_OWNER5_ACC_STATUS3_ADDR A:0x390500c
y.create.l HWIO_SPMI_PIC_ACC_ENABLE0_ADDR A:0x3800000
y.create.l HWIO_SPMI_PIC_ACC_ENABLE1_ADDR A:0x3801000
y.create.l HWIO_SPMI_PIC_ACC_ENABLE2_ADDR A:0x3802000
y.create.l HWIO_SPMI_PIC_ACC_ENABLE3_ADDR A:0x3803000
y.create.l HWIO_SPMI_PIC_ACC_ENABLE4_ADDR A:0x3804000
y.create.l HWIO_SPMI_PIC_ACC_ENABLE5_ADDR A:0x3805000
y.create.l HWIO_SPMI_PIC_ACC_ENABLE6_ADDR A:0x3806000
y.create.l HWIO_SPMI_PIC_ACC_ENABLE7_ADDR A:0x3807000
y.create.l HWIO_SPMI_PIC_ACC_ENABLE8_ADDR A:0x3808000
y.create.l HWIO_SPMI_PIC_ACC_ENABLE9_ADDR A:0x3809000
y.create.l HWIO_SPMI_PIC_IRQ_STATUS0_ADDR A:0x3800004
y.create.l HWIO_SPMI_PIC_IRQ_STATUS1_ADDR A:0x3801004
y.create.l HWIO_SPMI_PIC_IRQ_STATUS2_ADDR A:0x3802004
y.create.l HWIO_SPMI_PIC_IRQ_STATUS3_ADDR A:0x3803004
y.create.l HWIO_SPMI_PIC_IRQ_STATUS4_ADDR A:0x3804004
y.create.l HWIO_SPMI_PIC_IRQ_STATUS5_ADDR A:0x3805004
y.create.l HWIO_SPMI_PIC_IRQ_STATUS6_ADDR A:0x3806004
y.create.l HWIO_SPMI_PIC_IRQ_STATUS7_ADDR A:0x3807004
y.create.l HWIO_SPMI_PIC_IRQ_STATUS8_ADDR A:0x3808004
y.create.l HWIO_SPMI_PIC_IRQ_STATUS9_ADDR A:0x3809004
y.create.l HWIO_SPMI_PIC_IRQ_CLEAR0_ADDR A:0x3800008
y.create.l HWIO_SPMI_PIC_IRQ_CLEAR1_ADDR A:0x3801008
y.create.l HWIO_SPMI_PIC_IRQ_CLEAR2_ADDR A:0x3802008
y.create.l HWIO_SPMI_PIC_IRQ_CLEAR3_ADDR A:0x3803008
y.create.l HWIO_SPMI_PIC_IRQ_CLEAR4_ADDR A:0x3804008
y.create.l HWIO_SPMI_PIC_IRQ_CLEAR5_ADDR A:0x3805008
y.create.l HWIO_SPMI_PIC_IRQ_CLEAR6_ADDR A:0x3806008
y.create.l HWIO_SPMI_PIC_IRQ_CLEAR7_ADDR A:0x3807008
y.create.l HWIO_SPMI_PIC_IRQ_CLEAR8_ADDR A:0x3808008
y.create.l HWIO_SPMI_PIC_IRQ_CLEAR9_ADDR A:0x3809008
y.create.l HWIO_PMIC_ARB_XPU_SCR_ADDR A:0x200e000
y.create.l HWIO_PMIC_ARB_XPU_SWDR_ADDR A:0x200e004
y.create.l HWIO_PMIC_ARB_XPU_PRTN_RACR_SSHADOW_ADDR A:0x200e008
y.create.l HWIO_PMIC_ARB_XPU_PRTN_WACR_SSHADOW_ADDR A:0x200e00c
y.create.l HWIO_PMIC_ARB_XPU_PRTN_START_SSHADOW0_ADDR A:0x200e010
y.create.l HWIO_PMIC_ARB_XPU_PRTN_END_SSHADOW0_ADDR A:0x200e018
y.create.l HWIO_PMIC_ARB_XPU_SEAR0_ADDR A:0x200e040
y.create.l HWIO_PMIC_ARB_XPU_SESR_ADDR A:0x200e048
y.create.l HWIO_PMIC_ARB_XPU_SESRRESTORE_ADDR A:0x200e04c
y.create.l HWIO_PMIC_ARB_XPU_SESYNR0_ADDR A:0x200e050
y.create.l HWIO_PMIC_ARB_XPU_SESYNR1_ADDR A:0x200e054
y.create.l HWIO_PMIC_ARB_XPU_SESYNR2_ADDR A:0x200e058
y.create.l HWIO_PMIC_ARB_XPU_MCR_ADDR A:0x200e100
y.create.l HWIO_PMIC_ARB_XPU_MEAR0_ADDR A:0x200e140
y.create.l HWIO_PMIC_ARB_XPU_MESR_ADDR A:0x200e148
y.create.l HWIO_PMIC_ARB_XPU_MESRRESTORE_ADDR A:0x200e14c
y.create.l HWIO_PMIC_ARB_XPU_MESYNR0_ADDR A:0x200e150
y.create.l HWIO_PMIC_ARB_XPU_MESYNR1_ADDR A:0x200e154
y.create.l HWIO_PMIC_ARB_XPU_MESYNR2_ADDR A:0x200e158
y.create.l HWIO_PMIC_ARB_XPU_CR_ADDR A:0x200e080
y.create.l HWIO_PMIC_ARB_XPU_PRTN_RACR_SHADOW_ADDR A:0x200e088
y.create.l HWIO_PMIC_ARB_XPU_PRTN_WACR_SHADOW_ADDR A:0x200e08c
y.create.l HWIO_PMIC_ARB_XPU_PRTN_START_SHADOW0_ADDR A:0x200e090
y.create.l HWIO_PMIC_ARB_XPU_PRTN_END_SHADOW0_ADDR A:0x200e098
y.create.l HWIO_PMIC_ARB_XPU_RPU_ACR0_ADDR A:0x200e0a0
y.create.l HWIO_PMIC_ARB_XPU_EAR0_ADDR A:0x200e0c0
y.create.l HWIO_PMIC_ARB_XPU_ESR_ADDR A:0x200e0c8
y.create.l HWIO_PMIC_ARB_XPU_ESRRESTORE_ADDR A:0x200e0cc
y.create.l HWIO_PMIC_ARB_XPU_ESYNR0_ADDR A:0x200e0d0
y.create.l HWIO_PMIC_ARB_XPU_ESYNR1_ADDR A:0x200e0d4
y.create.l HWIO_PMIC_ARB_XPU_ESYNR2_ADDR A:0x200e0d8
y.create.l HWIO_PMIC_ARB_XPU_UMR_RACR_ADDR A:0x200e0e0
y.create.l HWIO_PMIC_ARB_XPU_UMR_WACR_ADDR A:0x200e0e4
y.create.l HWIO_PMIC_ARB_XPU_UMR_CNTL_ADDR A:0x200e0f0
y.create.l HWIO_PMIC_ARB_XPU_IDR0_ADDR A:0x200e074
y.create.l HWIO_PMIC_ARB_XPU_IDR1_ADDR A:0x200e078
y.create.l HWIO_PMIC_ARB_XPU_REV_ADDR A:0x200e07c
y.create.l HWIO_PMIC_ARB_XPU_PRT0_RACR0_ADDR A:0x200e200
y.create.l HWIO_PMIC_ARB_XPU_PRT1_RACR0_ADDR A:0x200e280
y.create.l HWIO_PMIC_ARB_XPU_PRT2_RACR0_ADDR A:0x200e300
y.create.l HWIO_PMIC_ARB_XPU_PRT3_RACR0_ADDR A:0x200e380
y.create.l HWIO_PMIC_ARB_XPU_PRT4_RACR0_ADDR A:0x200e400
y.create.l HWIO_PMIC_ARB_XPU_PRT5_RACR0_ADDR A:0x200e480
y.create.l HWIO_PMIC_ARB_XPU_PRT6_RACR0_ADDR A:0x200e500
y.create.l HWIO_PMIC_ARB_XPU_PRT7_RACR0_ADDR A:0x200e580
y.create.l HWIO_PMIC_ARB_XPU_PRT8_RACR0_ADDR A:0x200e600
y.create.l HWIO_PMIC_ARB_XPU_PRT9_RACR0_ADDR A:0x200e680
y.create.l HWIO_PMIC_ARB_XPU_PRT0_WACR0_ADDR A:0x200e220
y.create.l HWIO_PMIC_ARB_XPU_PRT1_WACR0_ADDR A:0x200e2a0
y.create.l HWIO_PMIC_ARB_XPU_PRT2_WACR0_ADDR A:0x200e320
y.create.l HWIO_PMIC_ARB_XPU_PRT3_WACR0_ADDR A:0x200e3a0
y.create.l HWIO_PMIC_ARB_XPU_PRT4_WACR0_ADDR A:0x200e420
y.create.l HWIO_PMIC_ARB_XPU_PRT5_WACR0_ADDR A:0x200e4a0
y.create.l HWIO_PMIC_ARB_XPU_PRT6_WACR0_ADDR A:0x200e520
y.create.l HWIO_PMIC_ARB_XPU_PRT7_WACR0_ADDR A:0x200e5a0
y.create.l HWIO_PMIC_ARB_XPU_PRT8_WACR0_ADDR A:0x200e620
y.create.l HWIO_PMIC_ARB_XPU_PRT9_WACR0_ADDR A:0x200e6a0
y.create.l HWIO_PMIC_ARB_XPU_PRT0_START0_ADDR A:0x200e240
y.create.l HWIO_PMIC_ARB_XPU_PRT1_START0_ADDR A:0x200e2c0
y.create.l HWIO_PMIC_ARB_XPU_PRT2_START0_ADDR A:0x200e340
y.create.l HWIO_PMIC_ARB_XPU_PRT3_START0_ADDR A:0x200e3c0
y.create.l HWIO_PMIC_ARB_XPU_PRT4_START0_ADDR A:0x200e440
y.create.l HWIO_PMIC_ARB_XPU_PRT5_START0_ADDR A:0x200e4c0
y.create.l HWIO_PMIC_ARB_XPU_PRT6_START0_ADDR A:0x200e540
y.create.l HWIO_PMIC_ARB_XPU_PRT7_START0_ADDR A:0x200e5c0
y.create.l HWIO_PMIC_ARB_XPU_PRT8_START0_ADDR A:0x200e640
y.create.l HWIO_PMIC_ARB_XPU_PRT9_START0_ADDR A:0x200e6c0
y.create.l HWIO_PMIC_ARB_XPU_PRT0_END0_ADDR A:0x200e248
y.create.l HWIO_PMIC_ARB_XPU_PRT1_END0_ADDR A:0x200e2c8
y.create.l HWIO_PMIC_ARB_XPU_PRT2_END0_ADDR A:0x200e348
y.create.l HWIO_PMIC_ARB_XPU_PRT3_END0_ADDR A:0x200e3c8
y.create.l HWIO_PMIC_ARB_XPU_PRT4_END0_ADDR A:0x200e448
y.create.l HWIO_PMIC_ARB_XPU_PRT5_END0_ADDR A:0x200e4c8
y.create.l HWIO_PMIC_ARB_XPU_PRT6_END0_ADDR A:0x200e548
y.create.l HWIO_PMIC_ARB_XPU_PRT7_END0_ADDR A:0x200e5c8
y.create.l HWIO_PMIC_ARB_XPU_PRT8_END0_ADDR A:0x200e648
y.create.l HWIO_PMIC_ARB_XPU_PRT9_END0_ADDR A:0x200e6c8
y.create.l HWIO_PMIC_ARB_XPU_PRT0_SCR_ADDR A:0x200e250
y.create.l HWIO_PMIC_ARB_XPU_PRT1_SCR_ADDR A:0x200e2d0
y.create.l HWIO_PMIC_ARB_XPU_PRT2_SCR_ADDR A:0x200e350
y.create.l HWIO_PMIC_ARB_XPU_PRT3_SCR_ADDR A:0x200e3d0
y.create.l HWIO_PMIC_ARB_XPU_PRT4_SCR_ADDR A:0x200e450
y.create.l HWIO_PMIC_ARB_XPU_PRT5_SCR_ADDR A:0x200e4d0
y.create.l HWIO_PMIC_ARB_XPU_PRT6_SCR_ADDR A:0x200e550
y.create.l HWIO_PMIC_ARB_XPU_PRT7_SCR_ADDR A:0x200e5d0
y.create.l HWIO_PMIC_ARB_XPU_PRT8_SCR_ADDR A:0x200e650
y.create.l HWIO_PMIC_ARB_XPU_PRT9_SCR_ADDR A:0x200e6d0
y.create.l HWIO_PMIC_ARB_XPU_PRT0_MCR_ADDR A:0x200e254
y.create.l HWIO_PMIC_ARB_XPU_PRT1_MCR_ADDR A:0x200e2d4
y.create.l HWIO_PMIC_ARB_XPU_PRT2_MCR_ADDR A:0x200e354
y.create.l HWIO_PMIC_ARB_XPU_PRT3_MCR_ADDR A:0x200e3d4
y.create.l HWIO_PMIC_ARB_XPU_PRT4_MCR_ADDR A:0x200e454
y.create.l HWIO_PMIC_ARB_XPU_PRT5_MCR_ADDR A:0x200e4d4
y.create.l HWIO_PMIC_ARB_XPU_PRT6_MCR_ADDR A:0x200e554
y.create.l HWIO_PMIC_ARB_XPU_PRT7_MCR_ADDR A:0x200e5d4
y.create.l HWIO_PMIC_ARB_XPU_PRT8_MCR_ADDR A:0x200e654
y.create.l HWIO_PMIC_ARB_XPU_PRT9_MCR_ADDR A:0x200e6d4
y.create.l HWIO_PMIC_ARB_XPU_PRT0_CNTL0_ADDR A:0x200e258
y.create.l HWIO_PMIC_ARB_XPU_PRT1_CNTL0_ADDR A:0x200e2d8
y.create.l HWIO_PMIC_ARB_XPU_PRT2_CNTL0_ADDR A:0x200e358
y.create.l HWIO_PMIC_ARB_XPU_PRT3_CNTL0_ADDR A:0x200e3d8
y.create.l HWIO_PMIC_ARB_XPU_PRT4_CNTL0_ADDR A:0x200e458
y.create.l HWIO_PMIC_ARB_XPU_PRT5_CNTL0_ADDR A:0x200e4d8
y.create.l HWIO_PMIC_ARB_XPU_PRT6_CNTL0_ADDR A:0x200e558
y.create.l HWIO_PMIC_ARB_XPU_PRT7_CNTL0_ADDR A:0x200e5d8
y.create.l HWIO_PMIC_ARB_XPU_PRT8_CNTL0_ADDR A:0x200e658
y.create.l HWIO_PMIC_ARB_XPU_PRT9_CNTL0_ADDR A:0x200e6d8
y.create.l HWIO_PMIC_ARB_XPU_PRT0_CNTL1_ADDR A:0x200e25c
y.create.l HWIO_PMIC_ARB_XPU_PRT1_CNTL1_ADDR A:0x200e2dc
y.create.l HWIO_PMIC_ARB_XPU_PRT2_CNTL1_ADDR A:0x200e35c
y.create.l HWIO_PMIC_ARB_XPU_PRT3_CNTL1_ADDR A:0x200e3dc
y.create.l HWIO_PMIC_ARB_XPU_PRT4_CNTL1_ADDR A:0x200e45c
y.create.l HWIO_PMIC_ARB_XPU_PRT5_CNTL1_ADDR A:0x200e4dc
y.create.l HWIO_PMIC_ARB_XPU_PRT6_CNTL1_ADDR A:0x200e55c
y.create.l HWIO_PMIC_ARB_XPU_PRT7_CNTL1_ADDR A:0x200e5dc
y.create.l HWIO_PMIC_ARB_XPU_PRT8_CNTL1_ADDR A:0x200e65c
y.create.l HWIO_PMIC_ARB_XPU_PRT9_CNTL1_ADDR A:0x200e6dc
y.create.l HWIO_PMIC_ARB_HW_VERSION_ADDR A:0x200f000
y.create.l HWIO_PMIC_ARB_MISC_CONFIG_ADDR A:0x200f004
y.create.l HWIO_PMIC_ARB_PVC_INTF_CTL_ADDR A:0x200f008
y.create.l HWIO_PMIC_ARB_PVC_INTF_STATUS_ADDR A:0x200f00c
y.create.l HWIO_PMIC_ARB_PRIORITIES0_ADDR A:0x200f100
y.create.l HWIO_PMIC_ARB_PRIORITIES1_ADDR A:0x200f104
y.create.l HWIO_PMIC_ARB_PRIORITIES2_ADDR A:0x200f108
y.create.l HWIO_PMIC_ARB_PRIORITIES3_ADDR A:0x200f10c
y.create.l HWIO_PMIC_ARB_PRIORITIES4_ADDR A:0x200f110
y.create.l HWIO_PMIC_ARB_PRIORITIES5_ADDR A:0x200f114
y.create.l HWIO_PMIC_ARB_PRIORITIES6_ADDR A:0x200f118
y.create.l HWIO_PMIC_ARB_PVC_PORT0_CTL_ADDR A:0x200f200
y.create.l HWIO_PMIC_ARB_PVC_PORT1_CTL_ADDR A:0x200f204
y.create.l HWIO_PMIC_ARB_PVC_PORT2_CTL_ADDR A:0x200f208
y.create.l HWIO_PMIC_ARB_PVC_PORT3_CTL_ADDR A:0x200f20c
y.create.l HWIO_PMIC_ARB_PVC_PORT4_CTL_ADDR A:0x200f210
y.create.l HWIO_PMIC_ARB_PVC_PORT5_CTL_ADDR A:0x200f214
y.create.l HWIO_PMIC_ARB_PVC_PORT0_STATUS_ADDR A:0x200f280
y.create.l HWIO_PMIC_ARB_PVC_PORT1_STATUS_ADDR A:0x200f284
y.create.l HWIO_PMIC_ARB_PVC_PORT2_STATUS_ADDR A:0x200f288
y.create.l HWIO_PMIC_ARB_PVC_PORT3_STATUS_ADDR A:0x200f28c
y.create.l HWIO_PMIC_ARB_PVC_PORT4_STATUS_ADDR A:0x200f290
y.create.l HWIO_PMIC_ARB_PVC_PORT5_STATUS_ADDR A:0x200f294
y.create.l HWIO_PMIC_ARB_PVC0_ADDR0_ADDR A:0x200f400
y.create.l HWIO_PMIC_ARB_PVC0_ADDR1_ADDR A:0x200f404
y.create.l HWIO_PMIC_ARB_PVC0_ADDR2_ADDR A:0x200f408
y.create.l HWIO_PMIC_ARB_PVC0_ADDR3_ADDR A:0x200f40c
y.create.l HWIO_PMIC_ARB_PVC1_ADDR0_ADDR A:0x200f420
y.create.l HWIO_PMIC_ARB_PVC1_ADDR1_ADDR A:0x200f424
y.create.l HWIO_PMIC_ARB_PVC1_ADDR2_ADDR A:0x200f428
y.create.l HWIO_PMIC_ARB_PVC1_ADDR3_ADDR A:0x200f42c
y.create.l HWIO_PMIC_ARB_PVC2_ADDR0_ADDR A:0x200f440
y.create.l HWIO_PMIC_ARB_PVC2_ADDR1_ADDR A:0x200f444
y.create.l HWIO_PMIC_ARB_PVC2_ADDR2_ADDR A:0x200f448
y.create.l HWIO_PMIC_ARB_PVC2_ADDR3_ADDR A:0x200f44c
y.create.l HWIO_PMIC_ARB_PVC3_ADDR0_ADDR A:0x200f460
y.create.l HWIO_PMIC_ARB_PVC3_ADDR1_ADDR A:0x200f464
y.create.l HWIO_PMIC_ARB_PVC3_ADDR2_ADDR A:0x200f468
y.create.l HWIO_PMIC_ARB_PVC3_ADDR3_ADDR A:0x200f46c
y.create.l HWIO_PMIC_ARB_PVC4_ADDR0_ADDR A:0x200f480
y.create.l HWIO_PMIC_ARB_PVC4_ADDR1_ADDR A:0x200f484
y.create.l HWIO_PMIC_ARB_PVC4_ADDR2_ADDR A:0x200f488
y.create.l HWIO_PMIC_ARB_PVC4_ADDR3_ADDR A:0x200f48c
y.create.l HWIO_PMIC_ARB_PVC5_ADDR0_ADDR A:0x200f4a0
y.create.l HWIO_PMIC_ARB_PVC5_ADDR1_ADDR A:0x200f4a4
y.create.l HWIO_PMIC_ARB_PVC5_ADDR2_ADDR A:0x200f4a8
y.create.l HWIO_PMIC_ARB_PVC5_ADDR3_ADDR A:0x200f4ac
y.create.l HWIO_PMIC_ARB_REG_CHNL0_ADDR A:0x200f800
y.create.l HWIO_PMIC_ARB_REG_CHNL1_ADDR A:0x200f804
y.create.l HWIO_PMIC_ARB_REG_CHNL2_ADDR A:0x200f808
y.create.l HWIO_PMIC_ARB_REG_CHNL3_ADDR A:0x200f80c
y.create.l HWIO_PMIC_ARB_REG_CHNL4_ADDR A:0x200f810
y.create.l HWIO_PMIC_ARB_REG_CHNL5_ADDR A:0x200f814
y.create.l HWIO_PMIC_ARB_REG_CHNL6_ADDR A:0x200f818
y.create.l HWIO_PMIC_ARB_REG_CHNL7_ADDR A:0x200f81c
y.create.l HWIO_PMIC_ARB_REG_CHNL8_ADDR A:0x200f820
y.create.l HWIO_PMIC_ARB_REG_CHNL9_ADDR A:0x200f824
y.create.l HWIO_PMIC_ARB0_CHNL0_CMD_ADDR A:0x2400000
y.create.l HWIO_PMIC_ARB0_CHNL1_CMD_ADDR A:0x2408000
y.create.l HWIO_PMIC_ARB0_CHNL2_CMD_ADDR A:0x2410000
y.create.l HWIO_PMIC_ARB0_CHNL3_CMD_ADDR A:0x2418000
y.create.l HWIO_PMIC_ARB1_CHNL0_CMD_ADDR A:0x2401000
y.create.l HWIO_PMIC_ARB1_CHNL1_CMD_ADDR A:0x2409000
y.create.l HWIO_PMIC_ARB1_CHNL2_CMD_ADDR A:0x2411000
y.create.l HWIO_PMIC_ARB1_CHNL3_CMD_ADDR A:0x2419000
y.create.l HWIO_PMIC_ARB2_CHNL0_CMD_ADDR A:0x2402000
y.create.l HWIO_PMIC_ARB2_CHNL1_CMD_ADDR A:0x240a000
y.create.l HWIO_PMIC_ARB2_CHNL2_CMD_ADDR A:0x2412000
y.create.l HWIO_PMIC_ARB2_CHNL3_CMD_ADDR A:0x241a000
y.create.l HWIO_PMIC_ARB3_CHNL0_CMD_ADDR A:0x2403000
y.create.l HWIO_PMIC_ARB3_CHNL1_CMD_ADDR A:0x240b000
y.create.l HWIO_PMIC_ARB3_CHNL2_CMD_ADDR A:0x2413000
y.create.l HWIO_PMIC_ARB3_CHNL3_CMD_ADDR A:0x241b000
y.create.l HWIO_PMIC_ARB4_CHNL0_CMD_ADDR A:0x2404000
y.create.l HWIO_PMIC_ARB4_CHNL1_CMD_ADDR A:0x240c000
y.create.l HWIO_PMIC_ARB4_CHNL2_CMD_ADDR A:0x2414000
y.create.l HWIO_PMIC_ARB4_CHNL3_CMD_ADDR A:0x241c000
y.create.l HWIO_PMIC_ARB5_CHNL0_CMD_ADDR A:0x2405000
y.create.l HWIO_PMIC_ARB5_CHNL1_CMD_ADDR A:0x240d000
y.create.l HWIO_PMIC_ARB5_CHNL2_CMD_ADDR A:0x2415000
y.create.l HWIO_PMIC_ARB5_CHNL3_CMD_ADDR A:0x241d000
y.create.l HWIO_PMIC_ARB0_CHNL0_CONFIG_ADDR A:0x2400004
y.create.l HWIO_PMIC_ARB0_CHNL1_CONFIG_ADDR A:0x2408004
y.create.l HWIO_PMIC_ARB0_CHNL2_CONFIG_ADDR A:0x2410004
y.create.l HWIO_PMIC_ARB0_CHNL3_CONFIG_ADDR A:0x2418004
y.create.l HWIO_PMIC_ARB1_CHNL0_CONFIG_ADDR A:0x2401004
y.create.l HWIO_PMIC_ARB1_CHNL1_CONFIG_ADDR A:0x2409004
y.create.l HWIO_PMIC_ARB1_CHNL2_CONFIG_ADDR A:0x2411004
y.create.l HWIO_PMIC_ARB1_CHNL3_CONFIG_ADDR A:0x2419004
y.create.l HWIO_PMIC_ARB2_CHNL0_CONFIG_ADDR A:0x2402004
y.create.l HWIO_PMIC_ARB2_CHNL1_CONFIG_ADDR A:0x240a004
y.create.l HWIO_PMIC_ARB2_CHNL2_CONFIG_ADDR A:0x2412004
y.create.l HWIO_PMIC_ARB2_CHNL3_CONFIG_ADDR A:0x241a004
y.create.l HWIO_PMIC_ARB3_CHNL0_CONFIG_ADDR A:0x2403004
y.create.l HWIO_PMIC_ARB3_CHNL1_CONFIG_ADDR A:0x240b004
y.create.l HWIO_PMIC_ARB3_CHNL2_CONFIG_ADDR A:0x2413004
y.create.l HWIO_PMIC_ARB3_CHNL3_CONFIG_ADDR A:0x241b004
y.create.l HWIO_PMIC_ARB4_CHNL0_CONFIG_ADDR A:0x2404004
y.create.l HWIO_PMIC_ARB4_CHNL1_CONFIG_ADDR A:0x240c004
y.create.l HWIO_PMIC_ARB4_CHNL2_CONFIG_ADDR A:0x2414004
y.create.l HWIO_PMIC_ARB4_CHNL3_CONFIG_ADDR A:0x241c004
y.create.l HWIO_PMIC_ARB5_CHNL0_CONFIG_ADDR A:0x2405004
y.create.l HWIO_PMIC_ARB5_CHNL1_CONFIG_ADDR A:0x240d004
y.create.l HWIO_PMIC_ARB5_CHNL2_CONFIG_ADDR A:0x2415004
y.create.l HWIO_PMIC_ARB5_CHNL3_CONFIG_ADDR A:0x241d004
y.create.l HWIO_PMIC_ARB0_CHNL0_STATUS_ADDR A:0x2400008
y.create.l HWIO_PMIC_ARB0_CHNL1_STATUS_ADDR A:0x2408008
y.create.l HWIO_PMIC_ARB0_CHNL2_STATUS_ADDR A:0x2410008
y.create.l HWIO_PMIC_ARB0_CHNL3_STATUS_ADDR A:0x2418008
y.create.l HWIO_PMIC_ARB1_CHNL0_STATUS_ADDR A:0x2401008
y.create.l HWIO_PMIC_ARB1_CHNL1_STATUS_ADDR A:0x2409008
y.create.l HWIO_PMIC_ARB1_CHNL2_STATUS_ADDR A:0x2411008
y.create.l HWIO_PMIC_ARB1_CHNL3_STATUS_ADDR A:0x2419008
y.create.l HWIO_PMIC_ARB2_CHNL0_STATUS_ADDR A:0x2402008
y.create.l HWIO_PMIC_ARB2_CHNL1_STATUS_ADDR A:0x240a008
y.create.l HWIO_PMIC_ARB2_CHNL2_STATUS_ADDR A:0x2412008
y.create.l HWIO_PMIC_ARB2_CHNL3_STATUS_ADDR A:0x241a008
y.create.l HWIO_PMIC_ARB3_CHNL0_STATUS_ADDR A:0x2403008
y.create.l HWIO_PMIC_ARB3_CHNL1_STATUS_ADDR A:0x240b008
y.create.l HWIO_PMIC_ARB3_CHNL2_STATUS_ADDR A:0x2413008
y.create.l HWIO_PMIC_ARB3_CHNL3_STATUS_ADDR A:0x241b008
y.create.l HWIO_PMIC_ARB4_CHNL0_STATUS_ADDR A:0x2404008
y.create.l HWIO_PMIC_ARB4_CHNL1_STATUS_ADDR A:0x240c008
y.create.l HWIO_PMIC_ARB4_CHNL2_STATUS_ADDR A:0x2414008
y.create.l HWIO_PMIC_ARB4_CHNL3_STATUS_ADDR A:0x241c008
y.create.l HWIO_PMIC_ARB5_CHNL0_STATUS_ADDR A:0x2405008
y.create.l HWIO_PMIC_ARB5_CHNL1_STATUS_ADDR A:0x240d008
y.create.l HWIO_PMIC_ARB5_CHNL2_STATUS_ADDR A:0x2415008
y.create.l HWIO_PMIC_ARB5_CHNL3_STATUS_ADDR A:0x241d008
y.create.l HWIO_PMIC_ARB0_CHNL0_WDATA0_ADDR A:0x2400010
y.create.l HWIO_PMIC_ARB0_CHNL1_WDATA0_ADDR A:0x2408010
y.create.l HWIO_PMIC_ARB0_CHNL2_WDATA0_ADDR A:0x2410010
y.create.l HWIO_PMIC_ARB0_CHNL3_WDATA0_ADDR A:0x2418010
y.create.l HWIO_PMIC_ARB1_CHNL0_WDATA0_ADDR A:0x2401010
y.create.l HWIO_PMIC_ARB1_CHNL1_WDATA0_ADDR A:0x2409010
y.create.l HWIO_PMIC_ARB1_CHNL2_WDATA0_ADDR A:0x2411010
y.create.l HWIO_PMIC_ARB1_CHNL3_WDATA0_ADDR A:0x2419010
y.create.l HWIO_PMIC_ARB2_CHNL0_WDATA0_ADDR A:0x2402010
y.create.l HWIO_PMIC_ARB2_CHNL1_WDATA0_ADDR A:0x240a010
y.create.l HWIO_PMIC_ARB2_CHNL2_WDATA0_ADDR A:0x2412010
y.create.l HWIO_PMIC_ARB2_CHNL3_WDATA0_ADDR A:0x241a010
y.create.l HWIO_PMIC_ARB3_CHNL0_WDATA0_ADDR A:0x2403010
y.create.l HWIO_PMIC_ARB3_CHNL1_WDATA0_ADDR A:0x240b010
y.create.l HWIO_PMIC_ARB3_CHNL2_WDATA0_ADDR A:0x2413010
y.create.l HWIO_PMIC_ARB3_CHNL3_WDATA0_ADDR A:0x241b010
y.create.l HWIO_PMIC_ARB4_CHNL0_WDATA0_ADDR A:0x2404010
y.create.l HWIO_PMIC_ARB4_CHNL1_WDATA0_ADDR A:0x240c010
y.create.l HWIO_PMIC_ARB4_CHNL2_WDATA0_ADDR A:0x2414010
y.create.l HWIO_PMIC_ARB4_CHNL3_WDATA0_ADDR A:0x241c010
y.create.l HWIO_PMIC_ARB5_CHNL0_WDATA0_ADDR A:0x2405010
y.create.l HWIO_PMIC_ARB5_CHNL1_WDATA0_ADDR A:0x240d010
y.create.l HWIO_PMIC_ARB5_CHNL2_WDATA0_ADDR A:0x2415010
y.create.l HWIO_PMIC_ARB5_CHNL3_WDATA0_ADDR A:0x241d010
y.create.l HWIO_PMIC_ARB0_CHNL0_WDATA1_ADDR A:0x2400014
y.create.l HWIO_PMIC_ARB0_CHNL1_WDATA1_ADDR A:0x2408014
y.create.l HWIO_PMIC_ARB0_CHNL2_WDATA1_ADDR A:0x2410014
y.create.l HWIO_PMIC_ARB0_CHNL3_WDATA1_ADDR A:0x2418014
y.create.l HWIO_PMIC_ARB1_CHNL0_WDATA1_ADDR A:0x2401014
y.create.l HWIO_PMIC_ARB1_CHNL1_WDATA1_ADDR A:0x2409014
y.create.l HWIO_PMIC_ARB1_CHNL2_WDATA1_ADDR A:0x2411014
y.create.l HWIO_PMIC_ARB1_CHNL3_WDATA1_ADDR A:0x2419014
y.create.l HWIO_PMIC_ARB2_CHNL0_WDATA1_ADDR A:0x2402014
y.create.l HWIO_PMIC_ARB2_CHNL1_WDATA1_ADDR A:0x240a014
y.create.l HWIO_PMIC_ARB2_CHNL2_WDATA1_ADDR A:0x2412014
y.create.l HWIO_PMIC_ARB2_CHNL3_WDATA1_ADDR A:0x241a014
y.create.l HWIO_PMIC_ARB3_CHNL0_WDATA1_ADDR A:0x2403014
y.create.l HWIO_PMIC_ARB3_CHNL1_WDATA1_ADDR A:0x240b014
y.create.l HWIO_PMIC_ARB3_CHNL2_WDATA1_ADDR A:0x2413014
y.create.l HWIO_PMIC_ARB3_CHNL3_WDATA1_ADDR A:0x241b014
y.create.l HWIO_PMIC_ARB4_CHNL0_WDATA1_ADDR A:0x2404014
y.create.l HWIO_PMIC_ARB4_CHNL1_WDATA1_ADDR A:0x240c014
y.create.l HWIO_PMIC_ARB4_CHNL2_WDATA1_ADDR A:0x2414014
y.create.l HWIO_PMIC_ARB4_CHNL3_WDATA1_ADDR A:0x241c014
y.create.l HWIO_PMIC_ARB5_CHNL0_WDATA1_ADDR A:0x2405014
y.create.l HWIO_PMIC_ARB5_CHNL1_WDATA1_ADDR A:0x240d014
y.create.l HWIO_PMIC_ARB5_CHNL2_WDATA1_ADDR A:0x2415014
y.create.l HWIO_PMIC_ARB5_CHNL3_WDATA1_ADDR A:0x241d014
y.create.l HWIO_PMIC_ARB0_CHNL0_RDATA0_ADDR A:0x2400018
y.create.l HWIO_PMIC_ARB0_CHNL1_RDATA0_ADDR A:0x2408018
y.create.l HWIO_PMIC_ARB0_CHNL2_RDATA0_ADDR A:0x2410018
y.create.l HWIO_PMIC_ARB0_CHNL3_RDATA0_ADDR A:0x2418018
y.create.l HWIO_PMIC_ARB1_CHNL0_RDATA0_ADDR A:0x2401018
y.create.l HWIO_PMIC_ARB1_CHNL1_RDATA0_ADDR A:0x2409018
y.create.l HWIO_PMIC_ARB1_CHNL2_RDATA0_ADDR A:0x2411018
y.create.l HWIO_PMIC_ARB1_CHNL3_RDATA0_ADDR A:0x2419018
y.create.l HWIO_PMIC_ARB2_CHNL0_RDATA0_ADDR A:0x2402018
y.create.l HWIO_PMIC_ARB2_CHNL1_RDATA0_ADDR A:0x240a018
y.create.l HWIO_PMIC_ARB2_CHNL2_RDATA0_ADDR A:0x2412018
y.create.l HWIO_PMIC_ARB2_CHNL3_RDATA0_ADDR A:0x241a018
y.create.l HWIO_PMIC_ARB3_CHNL0_RDATA0_ADDR A:0x2403018
y.create.l HWIO_PMIC_ARB3_CHNL1_RDATA0_ADDR A:0x240b018
y.create.l HWIO_PMIC_ARB3_CHNL2_RDATA0_ADDR A:0x2413018
y.create.l HWIO_PMIC_ARB3_CHNL3_RDATA0_ADDR A:0x241b018
y.create.l HWIO_PMIC_ARB4_CHNL0_RDATA0_ADDR A:0x2404018
y.create.l HWIO_PMIC_ARB4_CHNL1_RDATA0_ADDR A:0x240c018
y.create.l HWIO_PMIC_ARB4_CHNL2_RDATA0_ADDR A:0x2414018
y.create.l HWIO_PMIC_ARB4_CHNL3_RDATA0_ADDR A:0x241c018
y.create.l HWIO_PMIC_ARB5_CHNL0_RDATA0_ADDR A:0x2405018
y.create.l HWIO_PMIC_ARB5_CHNL1_RDATA0_ADDR A:0x240d018
y.create.l HWIO_PMIC_ARB5_CHNL2_RDATA0_ADDR A:0x2415018
y.create.l HWIO_PMIC_ARB5_CHNL3_RDATA0_ADDR A:0x241d018
y.create.l HWIO_PMIC_ARB0_CHNL0_RDATA1_ADDR A:0x240001c
y.create.l HWIO_PMIC_ARB0_CHNL1_RDATA1_ADDR A:0x240801c
y.create.l HWIO_PMIC_ARB0_CHNL2_RDATA1_ADDR A:0x241001c
y.create.l HWIO_PMIC_ARB0_CHNL3_RDATA1_ADDR A:0x241801c
y.create.l HWIO_PMIC_ARB1_CHNL0_RDATA1_ADDR A:0x240101c
y.create.l HWIO_PMIC_ARB1_CHNL1_RDATA1_ADDR A:0x240901c
y.create.l HWIO_PMIC_ARB1_CHNL2_RDATA1_ADDR A:0x241101c
y.create.l HWIO_PMIC_ARB1_CHNL3_RDATA1_ADDR A:0x241901c
y.create.l HWIO_PMIC_ARB2_CHNL0_RDATA1_ADDR A:0x240201c
y.create.l HWIO_PMIC_ARB2_CHNL1_RDATA1_ADDR A:0x240a01c
y.create.l HWIO_PMIC_ARB2_CHNL2_RDATA1_ADDR A:0x241201c
y.create.l HWIO_PMIC_ARB2_CHNL3_RDATA1_ADDR A:0x241a01c
y.create.l HWIO_PMIC_ARB3_CHNL0_RDATA1_ADDR A:0x240301c
y.create.l HWIO_PMIC_ARB3_CHNL1_RDATA1_ADDR A:0x240b01c
y.create.l HWIO_PMIC_ARB3_CHNL2_RDATA1_ADDR A:0x241301c
y.create.l HWIO_PMIC_ARB3_CHNL3_RDATA1_ADDR A:0x241b01c
y.create.l HWIO_PMIC_ARB4_CHNL0_RDATA1_ADDR A:0x240401c
y.create.l HWIO_PMIC_ARB4_CHNL1_RDATA1_ADDR A:0x240c01c
y.create.l HWIO_PMIC_ARB4_CHNL2_RDATA1_ADDR A:0x241401c
y.create.l HWIO_PMIC_ARB4_CHNL3_RDATA1_ADDR A:0x241c01c
y.create.l HWIO_PMIC_ARB5_CHNL0_RDATA1_ADDR A:0x240501c
y.create.l HWIO_PMIC_ARB5_CHNL1_RDATA1_ADDR A:0x240d01c
y.create.l HWIO_PMIC_ARB5_CHNL2_RDATA1_ADDR A:0x241501c
y.create.l HWIO_PMIC_ARB5_CHNL3_RDATA1_ADDR A:0x241d01c
y.create.l HWIO_PMIC_ARB0_CHNL0_RDATA2_ADDR A:0x2400020
y.create.l HWIO_PMIC_ARB0_CHNL1_RDATA2_ADDR A:0x2408020
y.create.l HWIO_PMIC_ARB0_CHNL2_RDATA2_ADDR A:0x2410020
y.create.l HWIO_PMIC_ARB0_CHNL3_RDATA2_ADDR A:0x2418020
y.create.l HWIO_PMIC_ARB1_CHNL0_RDATA2_ADDR A:0x2401020
y.create.l HWIO_PMIC_ARB1_CHNL1_RDATA2_ADDR A:0x2409020
y.create.l HWIO_PMIC_ARB1_CHNL2_RDATA2_ADDR A:0x2411020
y.create.l HWIO_PMIC_ARB1_CHNL3_RDATA2_ADDR A:0x2419020
y.create.l HWIO_PMIC_ARB2_CHNL0_RDATA2_ADDR A:0x2402020
y.create.l HWIO_PMIC_ARB2_CHNL1_RDATA2_ADDR A:0x240a020
y.create.l HWIO_PMIC_ARB2_CHNL2_RDATA2_ADDR A:0x2412020
y.create.l HWIO_PMIC_ARB2_CHNL3_RDATA2_ADDR A:0x241a020
y.create.l HWIO_PMIC_ARB3_CHNL0_RDATA2_ADDR A:0x2403020
y.create.l HWIO_PMIC_ARB3_CHNL1_RDATA2_ADDR A:0x240b020
y.create.l HWIO_PMIC_ARB3_CHNL2_RDATA2_ADDR A:0x2413020
y.create.l HWIO_PMIC_ARB3_CHNL3_RDATA2_ADDR A:0x241b020
y.create.l HWIO_PMIC_ARB4_CHNL0_RDATA2_ADDR A:0x2404020
y.create.l HWIO_PMIC_ARB4_CHNL1_RDATA2_ADDR A:0x240c020
y.create.l HWIO_PMIC_ARB4_CHNL2_RDATA2_ADDR A:0x2414020
y.create.l HWIO_PMIC_ARB4_CHNL3_RDATA2_ADDR A:0x241c020
y.create.l HWIO_PMIC_ARB5_CHNL0_RDATA2_ADDR A:0x2405020
y.create.l HWIO_PMIC_ARB5_CHNL1_RDATA2_ADDR A:0x240d020
y.create.l HWIO_PMIC_ARB5_CHNL2_RDATA2_ADDR A:0x2415020
y.create.l HWIO_PMIC_ARB5_CHNL3_RDATA2_ADDR A:0x241d020
y.create.l HWIO_PMIC_ARB_OBS0_CHNL0_CMD_ADDR A:0x2c00000
y.create.l HWIO_PMIC_ARB_OBS0_CHNL1_CMD_ADDR A:0x2c08000
y.create.l HWIO_PMIC_ARB_OBS0_CHNL2_CMD_ADDR A:0x2c10000
y.create.l HWIO_PMIC_ARB_OBS0_CHNL3_CMD_ADDR A:0x2c18000
y.create.l HWIO_PMIC_ARB_OBS1_CHNL0_CMD_ADDR A:0x2c01000
y.create.l HWIO_PMIC_ARB_OBS1_CHNL1_CMD_ADDR A:0x2c09000
y.create.l HWIO_PMIC_ARB_OBS1_CHNL2_CMD_ADDR A:0x2c11000
y.create.l HWIO_PMIC_ARB_OBS1_CHNL3_CMD_ADDR A:0x2c19000
y.create.l HWIO_PMIC_ARB_OBS2_CHNL0_CMD_ADDR A:0x2c02000
y.create.l HWIO_PMIC_ARB_OBS2_CHNL1_CMD_ADDR A:0x2c0a000
y.create.l HWIO_PMIC_ARB_OBS2_CHNL2_CMD_ADDR A:0x2c12000
y.create.l HWIO_PMIC_ARB_OBS2_CHNL3_CMD_ADDR A:0x2c1a000
y.create.l HWIO_PMIC_ARB_OBS3_CHNL0_CMD_ADDR A:0x2c03000
y.create.l HWIO_PMIC_ARB_OBS3_CHNL1_CMD_ADDR A:0x2c0b000
y.create.l HWIO_PMIC_ARB_OBS3_CHNL2_CMD_ADDR A:0x2c13000
y.create.l HWIO_PMIC_ARB_OBS3_CHNL3_CMD_ADDR A:0x2c1b000
y.create.l HWIO_PMIC_ARB_OBS4_CHNL0_CMD_ADDR A:0x2c04000
y.create.l HWIO_PMIC_ARB_OBS4_CHNL1_CMD_ADDR A:0x2c0c000
y.create.l HWIO_PMIC_ARB_OBS4_CHNL2_CMD_ADDR A:0x2c14000
y.create.l HWIO_PMIC_ARB_OBS4_CHNL3_CMD_ADDR A:0x2c1c000
y.create.l HWIO_PMIC_ARB_OBS5_CHNL0_CMD_ADDR A:0x2c05000
y.create.l HWIO_PMIC_ARB_OBS5_CHNL1_CMD_ADDR A:0x2c0d000
y.create.l HWIO_PMIC_ARB_OBS5_CHNL2_CMD_ADDR A:0x2c15000
y.create.l HWIO_PMIC_ARB_OBS5_CHNL3_CMD_ADDR A:0x2c1d000
y.create.l HWIO_PMIC_ARB_OBS0_CHNL0_CONFIG_ADDR A:0x2c00004
y.create.l HWIO_PMIC_ARB_OBS0_CHNL1_CONFIG_ADDR A:0x2c08004
y.create.l HWIO_PMIC_ARB_OBS0_CHNL2_CONFIG_ADDR A:0x2c10004
y.create.l HWIO_PMIC_ARB_OBS0_CHNL3_CONFIG_ADDR A:0x2c18004
y.create.l HWIO_PMIC_ARB_OBS1_CHNL0_CONFIG_ADDR A:0x2c01004
y.create.l HWIO_PMIC_ARB_OBS1_CHNL1_CONFIG_ADDR A:0x2c09004
y.create.l HWIO_PMIC_ARB_OBS1_CHNL2_CONFIG_ADDR A:0x2c11004
y.create.l HWIO_PMIC_ARB_OBS1_CHNL3_CONFIG_ADDR A:0x2c19004
y.create.l HWIO_PMIC_ARB_OBS2_CHNL0_CONFIG_ADDR A:0x2c02004
y.create.l HWIO_PMIC_ARB_OBS2_CHNL1_CONFIG_ADDR A:0x2c0a004
y.create.l HWIO_PMIC_ARB_OBS2_CHNL2_CONFIG_ADDR A:0x2c12004
y.create.l HWIO_PMIC_ARB_OBS2_CHNL3_CONFIG_ADDR A:0x2c1a004
y.create.l HWIO_PMIC_ARB_OBS3_CHNL0_CONFIG_ADDR A:0x2c03004
y.create.l HWIO_PMIC_ARB_OBS3_CHNL1_CONFIG_ADDR A:0x2c0b004
y.create.l HWIO_PMIC_ARB_OBS3_CHNL2_CONFIG_ADDR A:0x2c13004
y.create.l HWIO_PMIC_ARB_OBS3_CHNL3_CONFIG_ADDR A:0x2c1b004
y.create.l HWIO_PMIC_ARB_OBS4_CHNL0_CONFIG_ADDR A:0x2c04004
y.create.l HWIO_PMIC_ARB_OBS4_CHNL1_CONFIG_ADDR A:0x2c0c004
y.create.l HWIO_PMIC_ARB_OBS4_CHNL2_CONFIG_ADDR A:0x2c14004
y.create.l HWIO_PMIC_ARB_OBS4_CHNL3_CONFIG_ADDR A:0x2c1c004
y.create.l HWIO_PMIC_ARB_OBS5_CHNL0_CONFIG_ADDR A:0x2c05004
y.create.l HWIO_PMIC_ARB_OBS5_CHNL1_CONFIG_ADDR A:0x2c0d004
y.create.l HWIO_PMIC_ARB_OBS5_CHNL2_CONFIG_ADDR A:0x2c15004
y.create.l HWIO_PMIC_ARB_OBS5_CHNL3_CONFIG_ADDR A:0x2c1d004
y.create.l HWIO_PMIC_ARB_OBS0_CHNL0_STATUS_ADDR A:0x2c00008
y.create.l HWIO_PMIC_ARB_OBS0_CHNL1_STATUS_ADDR A:0x2c08008
y.create.l HWIO_PMIC_ARB_OBS0_CHNL2_STATUS_ADDR A:0x2c10008
y.create.l HWIO_PMIC_ARB_OBS0_CHNL3_STATUS_ADDR A:0x2c18008
y.create.l HWIO_PMIC_ARB_OBS1_CHNL0_STATUS_ADDR A:0x2c01008
y.create.l HWIO_PMIC_ARB_OBS1_CHNL1_STATUS_ADDR A:0x2c09008
y.create.l HWIO_PMIC_ARB_OBS1_CHNL2_STATUS_ADDR A:0x2c11008
y.create.l HWIO_PMIC_ARB_OBS1_CHNL3_STATUS_ADDR A:0x2c19008
y.create.l HWIO_PMIC_ARB_OBS2_CHNL0_STATUS_ADDR A:0x2c02008
y.create.l HWIO_PMIC_ARB_OBS2_CHNL1_STATUS_ADDR A:0x2c0a008
y.create.l HWIO_PMIC_ARB_OBS2_CHNL2_STATUS_ADDR A:0x2c12008
y.create.l HWIO_PMIC_ARB_OBS2_CHNL3_STATUS_ADDR A:0x2c1a008
y.create.l HWIO_PMIC_ARB_OBS3_CHNL0_STATUS_ADDR A:0x2c03008
y.create.l HWIO_PMIC_ARB_OBS3_CHNL1_STATUS_ADDR A:0x2c0b008
y.create.l HWIO_PMIC_ARB_OBS3_CHNL2_STATUS_ADDR A:0x2c13008
y.create.l HWIO_PMIC_ARB_OBS3_CHNL3_STATUS_ADDR A:0x2c1b008
y.create.l HWIO_PMIC_ARB_OBS4_CHNL0_STATUS_ADDR A:0x2c04008
y.create.l HWIO_PMIC_ARB_OBS4_CHNL1_STATUS_ADDR A:0x2c0c008
y.create.l HWIO_PMIC_ARB_OBS4_CHNL2_STATUS_ADDR A:0x2c14008
y.create.l HWIO_PMIC_ARB_OBS4_CHNL3_STATUS_ADDR A:0x2c1c008
y.create.l HWIO_PMIC_ARB_OBS5_CHNL0_STATUS_ADDR A:0x2c05008
y.create.l HWIO_PMIC_ARB_OBS5_CHNL1_STATUS_ADDR A:0x2c0d008
y.create.l HWIO_PMIC_ARB_OBS5_CHNL2_STATUS_ADDR A:0x2c15008
y.create.l HWIO_PMIC_ARB_OBS5_CHNL3_STATUS_ADDR A:0x2c1d008
y.create.l HWIO_PMIC_ARB_OBS0_CHNL0_RDATA0_ADDR A:0x2c00018
y.create.l HWIO_PMIC_ARB_OBS0_CHNL1_RDATA0_ADDR A:0x2c08018
y.create.l HWIO_PMIC_ARB_OBS0_CHNL2_RDATA0_ADDR A:0x2c10018
y.create.l HWIO_PMIC_ARB_OBS0_CHNL3_RDATA0_ADDR A:0x2c18018
y.create.l HWIO_PMIC_ARB_OBS1_CHNL0_RDATA0_ADDR A:0x2c01018
y.create.l HWIO_PMIC_ARB_OBS1_CHNL1_RDATA0_ADDR A:0x2c09018
y.create.l HWIO_PMIC_ARB_OBS1_CHNL2_RDATA0_ADDR A:0x2c11018
y.create.l HWIO_PMIC_ARB_OBS1_CHNL3_RDATA0_ADDR A:0x2c19018
y.create.l HWIO_PMIC_ARB_OBS2_CHNL0_RDATA0_ADDR A:0x2c02018
y.create.l HWIO_PMIC_ARB_OBS2_CHNL1_RDATA0_ADDR A:0x2c0a018
y.create.l HWIO_PMIC_ARB_OBS2_CHNL2_RDATA0_ADDR A:0x2c12018
y.create.l HWIO_PMIC_ARB_OBS2_CHNL3_RDATA0_ADDR A:0x2c1a018
y.create.l HWIO_PMIC_ARB_OBS3_CHNL0_RDATA0_ADDR A:0x2c03018
y.create.l HWIO_PMIC_ARB_OBS3_CHNL1_RDATA0_ADDR A:0x2c0b018
y.create.l HWIO_PMIC_ARB_OBS3_CHNL2_RDATA0_ADDR A:0x2c13018
y.create.l HWIO_PMIC_ARB_OBS3_CHNL3_RDATA0_ADDR A:0x2c1b018
y.create.l HWIO_PMIC_ARB_OBS4_CHNL0_RDATA0_ADDR A:0x2c04018
y.create.l HWIO_PMIC_ARB_OBS4_CHNL1_RDATA0_ADDR A:0x2c0c018
y.create.l HWIO_PMIC_ARB_OBS4_CHNL2_RDATA0_ADDR A:0x2c14018
y.create.l HWIO_PMIC_ARB_OBS4_CHNL3_RDATA0_ADDR A:0x2c1c018
y.create.l HWIO_PMIC_ARB_OBS5_CHNL0_RDATA0_ADDR A:0x2c05018
y.create.l HWIO_PMIC_ARB_OBS5_CHNL1_RDATA0_ADDR A:0x2c0d018
y.create.l HWIO_PMIC_ARB_OBS5_CHNL2_RDATA0_ADDR A:0x2c15018
y.create.l HWIO_PMIC_ARB_OBS5_CHNL3_RDATA0_ADDR A:0x2c1d018
y.create.l HWIO_PMIC_ARB_OBS0_CHNL0_RDATA1_ADDR A:0x2c0001c
y.create.l HWIO_PMIC_ARB_OBS0_CHNL1_RDATA1_ADDR A:0x2c0801c
y.create.l HWIO_PMIC_ARB_OBS0_CHNL2_RDATA1_ADDR A:0x2c1001c
y.create.l HWIO_PMIC_ARB_OBS0_CHNL3_RDATA1_ADDR A:0x2c1801c
y.create.l HWIO_PMIC_ARB_OBS1_CHNL0_RDATA1_ADDR A:0x2c0101c
y.create.l HWIO_PMIC_ARB_OBS1_CHNL1_RDATA1_ADDR A:0x2c0901c
y.create.l HWIO_PMIC_ARB_OBS1_CHNL2_RDATA1_ADDR A:0x2c1101c
y.create.l HWIO_PMIC_ARB_OBS1_CHNL3_RDATA1_ADDR A:0x2c1901c
y.create.l HWIO_PMIC_ARB_OBS2_CHNL0_RDATA1_ADDR A:0x2c0201c
y.create.l HWIO_PMIC_ARB_OBS2_CHNL1_RDATA1_ADDR A:0x2c0a01c
y.create.l HWIO_PMIC_ARB_OBS2_CHNL2_RDATA1_ADDR A:0x2c1201c
y.create.l HWIO_PMIC_ARB_OBS2_CHNL3_RDATA1_ADDR A:0x2c1a01c
y.create.l HWIO_PMIC_ARB_OBS3_CHNL0_RDATA1_ADDR A:0x2c0301c
y.create.l HWIO_PMIC_ARB_OBS3_CHNL1_RDATA1_ADDR A:0x2c0b01c
y.create.l HWIO_PMIC_ARB_OBS3_CHNL2_RDATA1_ADDR A:0x2c1301c
y.create.l HWIO_PMIC_ARB_OBS3_CHNL3_RDATA1_ADDR A:0x2c1b01c
y.create.l HWIO_PMIC_ARB_OBS4_CHNL0_RDATA1_ADDR A:0x2c0401c
y.create.l HWIO_PMIC_ARB_OBS4_CHNL1_RDATA1_ADDR A:0x2c0c01c
y.create.l HWIO_PMIC_ARB_OBS4_CHNL2_RDATA1_ADDR A:0x2c1401c
y.create.l HWIO_PMIC_ARB_OBS4_CHNL3_RDATA1_ADDR A:0x2c1c01c
y.create.l HWIO_PMIC_ARB_OBS5_CHNL0_RDATA1_ADDR A:0x2c0501c
y.create.l HWIO_PMIC_ARB_OBS5_CHNL1_RDATA1_ADDR A:0x2c0d01c
y.create.l HWIO_PMIC_ARB_OBS5_CHNL2_RDATA1_ADDR A:0x2c1501c
y.create.l HWIO_PMIC_ARB_OBS5_CHNL3_RDATA1_ADDR A:0x2c1d01c
y.create.l HWIO_PRNG_PRNG_DATA_OUT_ADDR A:0x22000
y.create.l HWIO_PRNG_PRNG_STATUS_ADDR A:0x22004
y.create.l HWIO_PRNG_PRNG_HW_VERSION_ADDR A:0x22008
y.create.l HWIO_PRNG_PRNG_ENTROPY_CNTR_ADDR A:0x22010
y.create.l HWIO_PRNG_PRNG_SAMPLE_CNTR_ADDR A:0x22014
y.create.l HWIO_PRNG_PRNG_GEN_CNTR_ADDR A:0x22018
y.create.l HWIO_PRNG_PRNG_RESEED_CNTR_ADDR A:0x2201c
y.create.l HWIO_PRNG_PRNG_INSTANTIATE_CNTR_ADDR A:0x22020
y.create.l HWIO_PRNG_PRNG_DEBUG_ADDR A:0x22024
y.create.l HWIO_PRNG_PRNG_LFSR_CFG_ADDR A:0x22100
y.create.l HWIO_PRNG_PRNG_CONFIG_ADDR A:0x22104
y.create.l HWIO_PRNG_PRNG_PERSONALIZATION_STRING_ADDR A:0x22108
y.create.l HWIO_PRNG_PRNG_NUM_ENTROPY_ADDR A:0x22110
y.create.l HWIO_PRNG_PRNG_SAMPLE_FREQ_ADDR A:0x22114
y.create.l HWIO_PRNG_PRNG_GEN_WORDS_ADDR A:0x22118
y.create.l HWIO_PRNG_PRNG_RESEED_FREQ_ADDR A:0x2211c
y.create.l HWIO_PRNG_PRNG_INSTANTIATE_FREQ_ADDR A:0x22120
y.create.l HWIO_QDSS_CORESIGHT_CSR_ROM_WORD_ADDR A:0x800000
y.create.l HWIO_QDSS_STM_ROM_WORD_ADDR A:0x800004
y.create.l HWIO_QDSS_CTI0_ROM_WORD_ADDR A:0x800008
y.create.l HWIO_QDSS_CTI1_ROM_WORD_ADDR A:0x80000c
y.create.l HWIO_QDSS_CTI2_ROM_WORD_ADDR A:0x800010
y.create.l HWIO_QDSS_CTI3_ROM_WORD_ADDR A:0x800014
y.create.l HWIO_QDSS_CTI4_ROM_WORD_ADDR A:0x800018
y.create.l HWIO_QDSS_CTI5_ROM_WORD_ADDR A:0x80001c
y.create.l HWIO_QDSS_CTI6_ROM_WORD_ADDR A:0x800020
y.create.l HWIO_QDSS_CTI7_ROM_WORD_ADDR A:0x800024
y.create.l HWIO_QDSS_CTI8_ROM_WORD_ADDR A:0x800028
y.create.l HWIO_QDSS_TPIU_ROM_WORD_ADDR A:0x80002c
y.create.l HWIO_QDSS_TFUN0_ROM_WORD_ADDR A:0x800030
y.create.l HWIO_QDSS_TREPL_ROM_WORD_ADDR A:0x800034
y.create.l HWIO_QDSS_ETBETF_ROM_WORD_ADDR A:0x800038
y.create.l HWIO_QDSS_ETR_ROM_WORD_ADDR A:0x80003c
y.create.l HWIO_QDSS_VENUS_CTI_ROM_WORD_ADDR A:0x800040
y.create.l HWIO_QDSS_VENUS_A9_ETM_ROM_WORD_ADDR A:0x800044
y.create.l HWIO_QDSS_PRONTO_A9_ETM_ROM_WORD_ADDR A:0x800048
y.create.l HWIO_QDSS_PRONTO_A9_CTI_ROM_WORD_ADDR A:0x80004c
y.create.l HWIO_QDSS_MSS_Q6_CTI_ROM_WORD_ADDR A:0x800050
y.create.l HWIO_QDSS_RPM_CM3_CTI_ROM_WORD_ADDR A:0x800054
y.create.l HWIO_QDSS_A7SS_PC0_DBG_ROM_WORD_ADDR A:0x800058
y.create.l HWIO_QDSS_A7SS_PC0_PM_ROM_WORD_ADDR A:0x80005c
y.create.l HWIO_QDSS_A7SS_PC1_DBG_ROM_WORD_ADDR A:0x800060
y.create.l HWIO_QDSS_A7SS_PC1_PM_ROM_WORD_ADDR A:0x800064
y.create.l HWIO_QDSS_A7SS_PC2_DBG_ROM_WORD_ADDR A:0x800068
y.create.l HWIO_QDSS_A7SS_PC2_PM_ROM_WORD_ADDR A:0x80006c
y.create.l HWIO_QDSS_A7SS_PC3_DBG_ROM_WORD_ADDR A:0x800070
y.create.l HWIO_QDSS_A7SS_PC3_PM_ROM_WORD_ADDR A:0x800074
y.create.l HWIO_QDSS_A7SS_PC0_ETM_ROM_WORD_ADDR A:0x800078
y.create.l HWIO_QDSS_A7SS_PC1_ETM_ROM_WORD_ADDR A:0x80007c
y.create.l HWIO_QDSS_A7SS_PC2_ETM_ROM_WORD_ADDR A:0x800080
y.create.l HWIO_QDSS_A7SS_PC3_ETM_ROM_WORD_ADDR A:0x800084
y.create.l HWIO_QDSS_A7SS_PC0_CTI_ROM_WORD_ADDR A:0x800088
y.create.l HWIO_QDSS_A7SS_PC1_CTI_ROM_WORD_ADDR A:0x80008c
y.create.l HWIO_QDSS_A7SS_PC2_CTI_ROM_WORD_ADDR A:0x800090
y.create.l HWIO_QDSS_A7SS_PC3_CTI_ROM_WORD_ADDR A:0x800094
y.create.l HWIO_QDSS_A7SS_TFUNNEL_ROM_WORD_ADDR A:0x800098
y.create.l HWIO_QDSS_QDSS_WRAPPER_2X1_FUNNEL_ROM_WORD_ADDR A:0x80009c
y.create.l HWIO_QDSS_QDSS_WRAPPER_8X1_FUNNEL_ROM_WORD_ADDR A:0x8000a0
y.create.l HWIO_QDSS_HWE_EXPD_MUX_CFG_ROM_WORD_ADDR A:0x8000a4
y.create.l HWIO_QDSS_DBGUI_CFG_ROM_WORD_ADDR A:0x8000a8
y.create.l HWIO_QDSS_DAPROM_PERIPHERAL_ID4_ADDR A:0x800fd0
y.create.l HWIO_QDSS_DAPROM_PERIPHERAL_ID5_ADDR A:0x800fd4
y.create.l HWIO_QDSS_DAPROM_PERIPHERAL_ID6_ADDR A:0x800fd8
y.create.l HWIO_QDSS_DAPROM_PERIPHERAL_ID7_ADDR A:0x800fdc
y.create.l HWIO_QDSS_DAPROM_PERIPHERAL_ID0_ADDR A:0x800fe0
y.create.l HWIO_QDSS_DAPROM_PERIPHERAL_ID1_ADDR A:0x800fe4
y.create.l HWIO_QDSS_DAPROM_PERIPHERAL_ID2_ADDR A:0x800fe8
y.create.l HWIO_QDSS_DAPROM_PERIPHERAL_ID3_ADDR A:0x800fec
y.create.l HWIO_QDSS_DAPROM_COMPONENT_ID0_ADDR A:0x800ff0
y.create.l HWIO_QDSS_DAPROM_COMPONENT_ID1_ADDR A:0x800ff4
y.create.l HWIO_QDSS_DAPROM_COMPONENT_ID2_ADDR A:0x800ff8
y.create.l HWIO_QDSS_DAPROM_COMPONENT_ID3_ADDR A:0x800ffc
y.create.l HWIO_QDSS_CS_QDSSCSR_SWDBGPWRCTRL_ADDR A:0x801000
y.create.l HWIO_QDSS_CS_QDSSCSR_SWDBGPWRACK_ADDR A:0x801004
y.create.l HWIO_QDSS_CS_QDSSCSR_SWSPADREG0_ADDR A:0x801008
y.create.l HWIO_QDSS_CS_QDSSCSR_SWSPADREG1_ADDR A:0x80100c
y.create.l HWIO_QDSS_CS_QDSSCSR_STMTRANSCTRL_ADDR A:0x801010
y.create.l HWIO_QDSS_CS_QDSSCSR_STMAWIDCTRL_ADDR A:0x801014
y.create.l HWIO_QDSS_CS_QDSSCSR_STMCHNOFST0_ADDR A:0x801018
y.create.l HWIO_QDSS_CS_QDSSCSR_STMCHNOFST1_ADDR A:0x80101c
y.create.l HWIO_QDSS_CS_QDSSCSR_STMEXTHWCTRL0_ADDR A:0x801020
y.create.l HWIO_QDSS_CS_QDSSCSR_STMEXTHWCTRL1_ADDR A:0x801024
y.create.l HWIO_QDSS_CS_QDSSCSR_STMEXTHWCTRL2_ADDR A:0x801028
y.create.l HWIO_QDSS_CS_QDSSCSR_STMEXTHWCTRL3_ADDR A:0x80102c
y.create.l HWIO_QDSS_CS_QDSSCSR_USBBAMCTRL_ADDR A:0x801030
y.create.l HWIO_QDSS_CS_QDSSCSR_USBFLSHCTRL_ADDR A:0x801034
y.create.l HWIO_QDSS_CS_QDSSCSR_TIMESTAMPCTRL_ADDR A:0x801038
y.create.l HWIO_QDSS_CS_QDSSCSR_AOTIMEVAL0_ADDR A:0x80103c
y.create.l HWIO_QDSS_CS_QDSSCSR_AOTIMEVAL1_ADDR A:0x801040
y.create.l HWIO_QDSS_CS_QDSSCSR_QDSSTIMEVAL0_ADDR A:0x801044
y.create.l HWIO_QDSS_CS_QDSSCSR_QDSSTIMEVAL1_ADDR A:0x801048
y.create.l HWIO_QDSS_CS_QDSSCSR_QDSSTIMELOAD0_ADDR A:0x80104c
y.create.l HWIO_QDSS_CS_QDSSCSR_QDSSTIMELOAD1_ADDR A:0x801050
y.create.l HWIO_QDSS_CS_QDSSCSR_DAPMSAVAL_ADDR A:0x801054
y.create.l HWIO_QDSS_CS_QDSSCSR_QDSSCLKVOTE_ADDR A:0x801058
y.create.l HWIO_QDSS_CS_QDSSCSR_QDSSCLKIPI_ADDR A:0x80105c
y.create.l HWIO_QDSS_CS_QDSSCSR_QDSSPWRREQIGNORE_ADDR A:0x801060
y.create.l HWIO_QDSS_CS_QDSSCSR_QDSSSPARE_ADDR A:0x801064
y.create.l HWIO_QDSS_CS_QDSSCSR_IPCAT_ADDR A:0x801068
y.create.l HWIO_QDSS_CS_QDSSCSR_ETRIRQCTRL_ADDR A:0x80106c
y.create.l HWIO_QDSS_CS_QDSSCSR_PRESERVEETF_ADDR A:0x801070
y.create.l HWIO_QDSS_CS_QDSSCSR_PRESERVEETR0_ADDR A:0x801074
y.create.l HWIO_QDSS_CS_QDSSCSR_PRESERVEETR1_ADDR A:0x801078
y.create.l HWIO_QDSS_CS_QDSSCSR_ITCTL_ADDR A:0x801f00
y.create.l HWIO_QDSS_CS_QDSSCSR_CLAIMSET_ADDR A:0x801fa0
y.create.l HWIO_QDSS_CS_QDSSCSR_CLAIMCLR_ADDR A:0x801fa4
y.create.l HWIO_QDSS_CS_QDSSCSR_LOCKACCESS_ADDR A:0x801fb0
y.create.l HWIO_QDSS_CS_QDSSCSR_LOCKSTATUS_ADDR A:0x801fb4
y.create.l HWIO_QDSS_CS_QDSSCSR_AUTHSTATUS_ADDR A:0x801fb8
y.create.l HWIO_QDSS_CS_QDSSCSR_DEVICEID_ADDR A:0x801fc8
y.create.l HWIO_QDSS_CS_QDSSCSR_DEVICETYPE_ADDR A:0x801fcc
y.create.l HWIO_QDSS_CS_QDSSCSR_PERIPHID4_ADDR A:0x801fd0
y.create.l HWIO_QDSS_CS_QDSSCSR_PERIPHID5_ADDR A:0x801fd4
y.create.l HWIO_QDSS_CS_QDSSCSR_PERIPHID6_ADDR A:0x801fd8
y.create.l HWIO_QDSS_CS_QDSSCSR_PERIPHID7_ADDR A:0x801fdc
y.create.l HWIO_QDSS_CS_QDSSCSR_PERIPHID0_ADDR A:0x801fe0
y.create.l HWIO_QDSS_CS_QDSSCSR_PERIPHID1_ADDR A:0x801fe4
y.create.l HWIO_QDSS_CS_QDSSCSR_PERIPHID2_ADDR A:0x801fe8
y.create.l HWIO_QDSS_CS_QDSSCSR_PERIPHID3_ADDR A:0x801fec
y.create.l HWIO_QDSS_CS_QDSSCSR_COMPID0_ADDR A:0x801ff0
y.create.l HWIO_QDSS_CS_QDSSCSR_COMPID1_ADDR A:0x801ff4
y.create.l HWIO_QDSS_CS_QDSSCSR_COMPID2_ADDR A:0x801ff8
y.create.l HWIO_QDSS_CS_QDSSCSR_COMPID3_ADDR A:0x801ffc
y.create.l HWIO_QDSS_STMDMASTARTR_ADDR A:0x802c04
y.create.l HWIO_QDSS_STMDMASTOPR_ADDR A:0x802c08
y.create.l HWIO_QDSS_STMDMASTATR_ADDR A:0x802c0c
y.create.l HWIO_QDSS_STMDMACTLR_ADDR A:0x802c10
y.create.l HWIO_QDSS_STMDMAIDR_ADDR A:0x802cfc
y.create.l HWIO_QDSS_STMHEER_ADDR A:0x802d00
y.create.l HWIO_QDSS_STMHETER_ADDR A:0x802d20
y.create.l HWIO_QDSS_STMHEMCR_ADDR A:0x802d64
y.create.l HWIO_QDSS_STMHEMASTR_ADDR A:0x802df4
y.create.l HWIO_QDSS_STMHEFEAT1R_ADDR A:0x802df8
y.create.l HWIO_QDSS_STMHEIDR_ADDR A:0x802dfc
y.create.l HWIO_QDSS_STMSPER_ADDR A:0x802e00
y.create.l HWIO_QDSS_STMSPTER_ADDR A:0x802e20
y.create.l HWIO_QDSS_STMSPSCR_ADDR A:0x802e60
y.create.l HWIO_QDSS_STMSPMSCR_ADDR A:0x802e64
y.create.l HWIO_QDSS_STMSPOVERRIDER_ADDR A:0x802e68
y.create.l HWIO_QDSS_STMSPMOVERRIDER_ADDR A:0x802e6c
y.create.l HWIO_QDSS_STMSPTRIGCSR_ADDR A:0x802e70
y.create.l HWIO_QDSS_STMTCSR_ADDR A:0x802e80
y.create.l HWIO_QDSS_STMTSSTIMR_ADDR A:0x802e84
y.create.l HWIO_QDSS_STMTSFREQR_ADDR A:0x802e8c
y.create.l HWIO_QDSS_STMSYNCR_ADDR A:0x802e90
y.create.l HWIO_QDSS_STMAUXCR_ADDR A:0x802e94
y.create.l HWIO_QDSS_STMSPFEAT1R_ADDR A:0x802ea0
y.create.l HWIO_QDSS_STMSPFEAT2R_ADDR A:0x802ea4
y.create.l HWIO_QDSS_STMSPFEAT3R_ADDR A:0x802ea8
y.create.l HWIO_QDSS_STMITTRIGGER_ADDR A:0x802ee8
y.create.l HWIO_QDSS_STMITATBDATA0_ADDR A:0x802eec
y.create.l HWIO_QDSS_STMITATBCTR2_ADDR A:0x802ef0
y.create.l HWIO_QDSS_STMITATBID_ADDR A:0x802ef4
y.create.l HWIO_QDSS_STMITATBCTR0_ADDR A:0x802ef8
y.create.l HWIO_QDSS_STMITCTRL_ADDR A:0x802f00
y.create.l HWIO_QDSS_STMCLAIMSET_ADDR A:0x802fa0
y.create.l HWIO_QDSS_STMCLAIMCLR_ADDR A:0x802fa4
y.create.l HWIO_QDSS_STMLAR_ADDR A:0x802fb0
y.create.l HWIO_QDSS_STMLSR_ADDR A:0x802fb4
y.create.l HWIO_QDSS_STMAUTHSTATUS_ADDR A:0x802fb8
y.create.l HWIO_QDSS_STMDEVID_ADDR A:0x802fc8
y.create.l HWIO_QDSS_STMDEVTYPE_ADDR A:0x802fcc
y.create.l HWIO_QDSS_STMPIDR0_ADDR A:0x802fe0
y.create.l HWIO_QDSS_STMPIDR1_ADDR A:0x802fe4
y.create.l HWIO_QDSS_STMPIDR2_ADDR A:0x802fe8
y.create.l HWIO_QDSS_STMPIDR3_ADDR A:0x802fec
y.create.l HWIO_QDSS_STMPIDR4_ADDR A:0x802fd0
y.create.l HWIO_QDSS_STMPIDR5_ADDR A:0x802fd4
y.create.l HWIO_QDSS_STMPIDR6_ADDR A:0x802fd8
y.create.l HWIO_QDSS_STMPIDR7_ADDR A:0x802fdc
y.create.l HWIO_QDSS_STMCIDR0_ADDR A:0x802ff0
y.create.l HWIO_QDSS_STMCIDR1_ADDR A:0x802ff4
y.create.l HWIO_QDSS_STMCIDR2_ADDR A:0x802ff8
y.create.l HWIO_QDSS_STMCIDR3_ADDR A:0x802ffc
y.create.l HWIO_QDSS_CTI0_CTICONTROL_ADDR A:0x810000
y.create.l HWIO_QDSS_CTI0_CTIINTACK_ADDR A:0x810010
y.create.l HWIO_QDSS_CTI0_CTIAPPSET_ADDR A:0x810014
y.create.l HWIO_QDSS_CTI0_CTIAPPCLEAR_ADDR A:0x810018
y.create.l HWIO_QDSS_CTI0_CTIAPPPULSE_ADDR A:0x81001c
y.create.l HWIO_QDSS_CTI0_CTIINEN0_ADDR A:0x810020
y.create.l HWIO_QDSS_CTI0_CTIINEN1_ADDR A:0x810024
y.create.l HWIO_QDSS_CTI0_CTIINEN2_ADDR A:0x810028
y.create.l HWIO_QDSS_CTI0_CTIINEN3_ADDR A:0x81002c
y.create.l HWIO_QDSS_CTI0_CTIINEN4_ADDR A:0x810030
y.create.l HWIO_QDSS_CTI0_CTIINEN5_ADDR A:0x810034
y.create.l HWIO_QDSS_CTI0_CTIINEN6_ADDR A:0x810038
y.create.l HWIO_QDSS_CTI0_CTIINEN7_ADDR A:0x81003c
y.create.l HWIO_QDSS_CTI0_CTIOUTEN0_ADDR A:0x8100a0
y.create.l HWIO_QDSS_CTI0_CTIOUTEN1_ADDR A:0x8100a4
y.create.l HWIO_QDSS_CTI0_CTIOUTEN2_ADDR A:0x8100a8
y.create.l HWIO_QDSS_CTI0_CTIOUTEN3_ADDR A:0x8100ac
y.create.l HWIO_QDSS_CTI0_CTIOUTEN4_ADDR A:0x8100b0
y.create.l HWIO_QDSS_CTI0_CTIOUTEN5_ADDR A:0x8100b4
y.create.l HWIO_QDSS_CTI0_CTIOUTEN6_ADDR A:0x8100b8
y.create.l HWIO_QDSS_CTI0_CTIOUTEN7_ADDR A:0x8100bc
y.create.l HWIO_QDSS_CTI0_CTITRIGINSTATUS_ADDR A:0x810130
y.create.l HWIO_QDSS_CTI0_CTITRIGOUTSTATUS_ADDR A:0x810134
y.create.l HWIO_QDSS_CTI0_CTICHINSTATUS_ADDR A:0x810138
y.create.l HWIO_QDSS_CTI0_CTICHOUTSTATUS_ADDR A:0x81013c
y.create.l HWIO_QDSS_CTI0_CTIGATE_ADDR A:0x810140
y.create.l HWIO_QDSS_CTI0_ASICCTL_ADDR A:0x810144
y.create.l HWIO_QDSS_CTI0_ITCHINACK_ADDR A:0x810edc
y.create.l HWIO_QDSS_CTI0_ITTRIGINACK_ADDR A:0x810ee0
y.create.l HWIO_QDSS_CTI0_ITCHOUT_ADDR A:0x810ee4
y.create.l HWIO_QDSS_CTI0_ITTRIGOUT_ADDR A:0x810ee8
y.create.l HWIO_QDSS_CTI0_ITCHOUTACK_ADDR A:0x810eec
y.create.l HWIO_QDSS_CTI0_ITTRIGOUTACK_ADDR A:0x810ef0
y.create.l HWIO_QDSS_CTI0_ITCHIN_ADDR A:0x810ef4
y.create.l HWIO_QDSS_CTI0_ITTRIGIN_ADDR A:0x810ef8
y.create.l HWIO_QDSS_CTI0_ITCTRL_ADDR A:0x810f00
y.create.l HWIO_QDSS_CTI0_CLAIMSET_ADDR A:0x810fa0
y.create.l HWIO_QDSS_CTI0_CLAIMCLR_ADDR A:0x810fa4
y.create.l HWIO_QDSS_CTI0_LAR_ADDR A:0x810fb0
y.create.l HWIO_QDSS_CTI0_LSR_ADDR A:0x810fb4
y.create.l HWIO_QDSS_CTI0_AUTHSTATUS_ADDR A:0x810fb8
y.create.l HWIO_QDSS_CTI0_DEVID_ADDR A:0x810fc8
y.create.l HWIO_QDSS_CTI0_DEVTYPE_ADDR A:0x810fcc
y.create.l HWIO_QDSS_CTI0_PERIPHID0_ADDR A:0x810fe0
y.create.l HWIO_QDSS_CTI0_PERIPHID1_ADDR A:0x810fe4
y.create.l HWIO_QDSS_CTI0_PERIPHID2_ADDR A:0x810fe8
y.create.l HWIO_QDSS_CTI0_PERIPHID3_ADDR A:0x810fec
y.create.l HWIO_QDSS_CTI0_PERIPHID4_ADDR A:0x810fd0
y.create.l HWIO_QDSS_CTI0_PERIPHID5_ADDR A:0x810fd4
y.create.l HWIO_QDSS_CTI0_PERIPHID6_ADDR A:0x810fd8
y.create.l HWIO_QDSS_CTI0_PERIPHID7_ADDR A:0x810fdc
y.create.l HWIO_QDSS_CTI0_COMPID0_ADDR A:0x810ff0
y.create.l HWIO_QDSS_CTI0_COMPID1_ADDR A:0x810ff4
y.create.l HWIO_QDSS_CTI0_COMPID2_ADDR A:0x810ff8
y.create.l HWIO_QDSS_CTI0_COMPID3_ADDR A:0x810ffc
y.create.l HWIO_QDSS_CTI1_CTICONTROL_ADDR A:0x811000
y.create.l HWIO_QDSS_CTI1_CTIINTACK_ADDR A:0x811010
y.create.l HWIO_QDSS_CTI1_CTIAPPSET_ADDR A:0x811014
y.create.l HWIO_QDSS_CTI1_CTIAPPCLEAR_ADDR A:0x811018
y.create.l HWIO_QDSS_CTI1_CTIAPPPULSE_ADDR A:0x81101c
y.create.l HWIO_QDSS_CTI1_CTIINEN0_ADDR A:0x811020
y.create.l HWIO_QDSS_CTI1_CTIINEN1_ADDR A:0x811024
y.create.l HWIO_QDSS_CTI1_CTIINEN2_ADDR A:0x811028
y.create.l HWIO_QDSS_CTI1_CTIINEN3_ADDR A:0x81102c
y.create.l HWIO_QDSS_CTI1_CTIINEN4_ADDR A:0x811030
y.create.l HWIO_QDSS_CTI1_CTIINEN5_ADDR A:0x811034
y.create.l HWIO_QDSS_CTI1_CTIINEN6_ADDR A:0x811038
y.create.l HWIO_QDSS_CTI1_CTIINEN7_ADDR A:0x81103c
y.create.l HWIO_QDSS_CTI1_CTIOUTEN0_ADDR A:0x8110a0
y.create.l HWIO_QDSS_CTI1_CTIOUTEN1_ADDR A:0x8110a4
y.create.l HWIO_QDSS_CTI1_CTIOUTEN2_ADDR A:0x8110a8
y.create.l HWIO_QDSS_CTI1_CTIOUTEN3_ADDR A:0x8110ac
y.create.l HWIO_QDSS_CTI1_CTIOUTEN4_ADDR A:0x8110b0
y.create.l HWIO_QDSS_CTI1_CTIOUTEN5_ADDR A:0x8110b4
y.create.l HWIO_QDSS_CTI1_CTIOUTEN6_ADDR A:0x8110b8
y.create.l HWIO_QDSS_CTI1_CTIOUTEN7_ADDR A:0x8110bc
y.create.l HWIO_QDSS_CTI1_CTITRIGINSTATUS_ADDR A:0x811130
y.create.l HWIO_QDSS_CTI1_CTITRIGOUTSTATUS_ADDR A:0x811134
y.create.l HWIO_QDSS_CTI1_CTICHINSTATUS_ADDR A:0x811138
y.create.l HWIO_QDSS_CTI1_CTICHOUTSTATUS_ADDR A:0x81113c
y.create.l HWIO_QDSS_CTI1_CTIGATE_ADDR A:0x811140
y.create.l HWIO_QDSS_CTI1_ASICCTL_ADDR A:0x811144
y.create.l HWIO_QDSS_CTI1_ITCHINACK_ADDR A:0x811edc
y.create.l HWIO_QDSS_CTI1_ITTRIGINACK_ADDR A:0x811ee0
y.create.l HWIO_QDSS_CTI1_ITCHOUT_ADDR A:0x811ee4
y.create.l HWIO_QDSS_CTI1_ITTRIGOUT_ADDR A:0x811ee8
y.create.l HWIO_QDSS_CTI1_ITCHOUTACK_ADDR A:0x811eec
y.create.l HWIO_QDSS_CTI1_ITTRIGOUTACK_ADDR A:0x811ef0
y.create.l HWIO_QDSS_CTI1_ITCHIN_ADDR A:0x811ef4
y.create.l HWIO_QDSS_CTI1_ITTRIGIN_ADDR A:0x811ef8
y.create.l HWIO_QDSS_CTI1_ITCTRL_ADDR A:0x811f00
y.create.l HWIO_QDSS_CTI1_CLAIMSET_ADDR A:0x811fa0
y.create.l HWIO_QDSS_CTI1_CLAIMCLR_ADDR A:0x811fa4
y.create.l HWIO_QDSS_CTI1_LAR_ADDR A:0x811fb0
y.create.l HWIO_QDSS_CTI1_LSR_ADDR A:0x811fb4
y.create.l HWIO_QDSS_CTI1_AUTHSTATUS_ADDR A:0x811fb8
y.create.l HWIO_QDSS_CTI1_DEVID_ADDR A:0x811fc8
y.create.l HWIO_QDSS_CTI1_DEVTYPE_ADDR A:0x811fcc
y.create.l HWIO_QDSS_CTI1_PERIPHID0_ADDR A:0x811fe0
y.create.l HWIO_QDSS_CTI1_PERIPHID1_ADDR A:0x811fe4
y.create.l HWIO_QDSS_CTI1_PERIPHID2_ADDR A:0x811fe8
y.create.l HWIO_QDSS_CTI1_PERIPHID3_ADDR A:0x811fec
y.create.l HWIO_QDSS_CTI1_PERIPHID4_ADDR A:0x811fd0
y.create.l HWIO_QDSS_CTI1_PERIPHID5_ADDR A:0x811fd4
y.create.l HWIO_QDSS_CTI1_PERIPHID6_ADDR A:0x811fd8
y.create.l HWIO_QDSS_CTI1_PERIPHID7_ADDR A:0x811fdc
y.create.l HWIO_QDSS_CTI1_COMPID0_ADDR A:0x811ff0
y.create.l HWIO_QDSS_CTI1_COMPID1_ADDR A:0x811ff4
y.create.l HWIO_QDSS_CTI1_COMPID2_ADDR A:0x811ff8
y.create.l HWIO_QDSS_CTI1_COMPID3_ADDR A:0x811ffc
y.create.l HWIO_QDSS_CTI2_CTICONTROL_ADDR A:0x812000
y.create.l HWIO_QDSS_CTI2_CTIINTACK_ADDR A:0x812010
y.create.l HWIO_QDSS_CTI2_CTIAPPSET_ADDR A:0x812014
y.create.l HWIO_QDSS_CTI2_CTIAPPCLEAR_ADDR A:0x812018
y.create.l HWIO_QDSS_CTI2_CTIAPPPULSE_ADDR A:0x81201c
y.create.l HWIO_QDSS_CTI2_CTIINEN0_ADDR A:0x812020
y.create.l HWIO_QDSS_CTI2_CTIINEN1_ADDR A:0x812024
y.create.l HWIO_QDSS_CTI2_CTIINEN2_ADDR A:0x812028
y.create.l HWIO_QDSS_CTI2_CTIINEN3_ADDR A:0x81202c
y.create.l HWIO_QDSS_CTI2_CTIINEN4_ADDR A:0x812030
y.create.l HWIO_QDSS_CTI2_CTIINEN5_ADDR A:0x812034
y.create.l HWIO_QDSS_CTI2_CTIINEN6_ADDR A:0x812038
y.create.l HWIO_QDSS_CTI2_CTIINEN7_ADDR A:0x81203c
y.create.l HWIO_QDSS_CTI2_CTIOUTEN0_ADDR A:0x8120a0
y.create.l HWIO_QDSS_CTI2_CTIOUTEN1_ADDR A:0x8120a4
y.create.l HWIO_QDSS_CTI2_CTIOUTEN2_ADDR A:0x8120a8
y.create.l HWIO_QDSS_CTI2_CTIOUTEN3_ADDR A:0x8120ac
y.create.l HWIO_QDSS_CTI2_CTIOUTEN4_ADDR A:0x8120b0
y.create.l HWIO_QDSS_CTI2_CTIOUTEN5_ADDR A:0x8120b4
y.create.l HWIO_QDSS_CTI2_CTIOUTEN6_ADDR A:0x8120b8
y.create.l HWIO_QDSS_CTI2_CTIOUTEN7_ADDR A:0x8120bc
y.create.l HWIO_QDSS_CTI2_CTITRIGINSTATUS_ADDR A:0x812130
y.create.l HWIO_QDSS_CTI2_CTITRIGOUTSTATUS_ADDR A:0x812134
y.create.l HWIO_QDSS_CTI2_CTICHINSTATUS_ADDR A:0x812138
y.create.l HWIO_QDSS_CTI2_CTICHOUTSTATUS_ADDR A:0x81213c
y.create.l HWIO_QDSS_CTI2_CTIGATE_ADDR A:0x812140
y.create.l HWIO_QDSS_CTI2_ASICCTL_ADDR A:0x812144
y.create.l HWIO_QDSS_CTI2_ITCHINACK_ADDR A:0x812edc
y.create.l HWIO_QDSS_CTI2_ITTRIGINACK_ADDR A:0x812ee0
y.create.l HWIO_QDSS_CTI2_ITCHOUT_ADDR A:0x812ee4
y.create.l HWIO_QDSS_CTI2_ITTRIGOUT_ADDR A:0x812ee8
y.create.l HWIO_QDSS_CTI2_ITCHOUTACK_ADDR A:0x812eec
y.create.l HWIO_QDSS_CTI2_ITTRIGOUTACK_ADDR A:0x812ef0
y.create.l HWIO_QDSS_CTI2_ITCHIN_ADDR A:0x812ef4
y.create.l HWIO_QDSS_CTI2_ITTRIGIN_ADDR A:0x812ef8
y.create.l HWIO_QDSS_CTI2_ITCTRL_ADDR A:0x812f00
y.create.l HWIO_QDSS_CTI2_CLAIMSET_ADDR A:0x812fa0
y.create.l HWIO_QDSS_CTI2_CLAIMCLR_ADDR A:0x812fa4
y.create.l HWIO_QDSS_CTI2_LAR_ADDR A:0x812fb0
y.create.l HWIO_QDSS_CTI2_LSR_ADDR A:0x812fb4
y.create.l HWIO_QDSS_CTI2_AUTHSTATUS_ADDR A:0x812fb8
y.create.l HWIO_QDSS_CTI2_DEVID_ADDR A:0x812fc8
y.create.l HWIO_QDSS_CTI2_DEVTYPE_ADDR A:0x812fcc
y.create.l HWIO_QDSS_CTI2_PERIPHID0_ADDR A:0x812fe0
y.create.l HWIO_QDSS_CTI2_PERIPHID1_ADDR A:0x812fe4
y.create.l HWIO_QDSS_CTI2_PERIPHID2_ADDR A:0x812fe8
y.create.l HWIO_QDSS_CTI2_PERIPHID3_ADDR A:0x812fec
y.create.l HWIO_QDSS_CTI2_PERIPHID4_ADDR A:0x812fd0
y.create.l HWIO_QDSS_CTI2_PERIPHID5_ADDR A:0x812fd4
y.create.l HWIO_QDSS_CTI2_PERIPHID6_ADDR A:0x812fd8
y.create.l HWIO_QDSS_CTI2_PERIPHID7_ADDR A:0x812fdc
y.create.l HWIO_QDSS_CTI2_COMPID0_ADDR A:0x812ff0
y.create.l HWIO_QDSS_CTI2_COMPID1_ADDR A:0x812ff4
y.create.l HWIO_QDSS_CTI2_COMPID2_ADDR A:0x812ff8
y.create.l HWIO_QDSS_CTI2_COMPID3_ADDR A:0x812ffc
y.create.l HWIO_QDSS_CTI3_CTICONTROL_ADDR A:0x813000
y.create.l HWIO_QDSS_CTI3_CTIINTACK_ADDR A:0x813010
y.create.l HWIO_QDSS_CTI3_CTIAPPSET_ADDR A:0x813014
y.create.l HWIO_QDSS_CTI3_CTIAPPCLEAR_ADDR A:0x813018
y.create.l HWIO_QDSS_CTI3_CTIAPPPULSE_ADDR A:0x81301c
y.create.l HWIO_QDSS_CTI3_CTIINEN0_ADDR A:0x813020
y.create.l HWIO_QDSS_CTI3_CTIINEN1_ADDR A:0x813024
y.create.l HWIO_QDSS_CTI3_CTIINEN2_ADDR A:0x813028
y.create.l HWIO_QDSS_CTI3_CTIINEN3_ADDR A:0x81302c
y.create.l HWIO_QDSS_CTI3_CTIINEN4_ADDR A:0x813030
y.create.l HWIO_QDSS_CTI3_CTIINEN5_ADDR A:0x813034
y.create.l HWIO_QDSS_CTI3_CTIINEN6_ADDR A:0x813038
y.create.l HWIO_QDSS_CTI3_CTIINEN7_ADDR A:0x81303c
y.create.l HWIO_QDSS_CTI3_CTIOUTEN0_ADDR A:0x8130a0
y.create.l HWIO_QDSS_CTI3_CTIOUTEN1_ADDR A:0x8130a4
y.create.l HWIO_QDSS_CTI3_CTIOUTEN2_ADDR A:0x8130a8
y.create.l HWIO_QDSS_CTI3_CTIOUTEN3_ADDR A:0x8130ac
y.create.l HWIO_QDSS_CTI3_CTIOUTEN4_ADDR A:0x8130b0
y.create.l HWIO_QDSS_CTI3_CTIOUTEN5_ADDR A:0x8130b4
y.create.l HWIO_QDSS_CTI3_CTIOUTEN6_ADDR A:0x8130b8
y.create.l HWIO_QDSS_CTI3_CTIOUTEN7_ADDR A:0x8130bc
y.create.l HWIO_QDSS_CTI3_CTITRIGINSTATUS_ADDR A:0x813130
y.create.l HWIO_QDSS_CTI3_CTITRIGOUTSTATUS_ADDR A:0x813134
y.create.l HWIO_QDSS_CTI3_CTICHINSTATUS_ADDR A:0x813138
y.create.l HWIO_QDSS_CTI3_CTICHOUTSTATUS_ADDR A:0x81313c
y.create.l HWIO_QDSS_CTI3_CTIGATE_ADDR A:0x813140
y.create.l HWIO_QDSS_CTI3_ASICCTL_ADDR A:0x813144
y.create.l HWIO_QDSS_CTI3_ITCHINACK_ADDR A:0x813edc
y.create.l HWIO_QDSS_CTI3_ITTRIGINACK_ADDR A:0x813ee0
y.create.l HWIO_QDSS_CTI3_ITCHOUT_ADDR A:0x813ee4
y.create.l HWIO_QDSS_CTI3_ITTRIGOUT_ADDR A:0x813ee8
y.create.l HWIO_QDSS_CTI3_ITCHOUTACK_ADDR A:0x813eec
y.create.l HWIO_QDSS_CTI3_ITTRIGOUTACK_ADDR A:0x813ef0
y.create.l HWIO_QDSS_CTI3_ITCHIN_ADDR A:0x813ef4
y.create.l HWIO_QDSS_CTI3_ITTRIGIN_ADDR A:0x813ef8
y.create.l HWIO_QDSS_CTI3_ITCTRL_ADDR A:0x813f00
y.create.l HWIO_QDSS_CTI3_CLAIMSET_ADDR A:0x813fa0
y.create.l HWIO_QDSS_CTI3_CLAIMCLR_ADDR A:0x813fa4
y.create.l HWIO_QDSS_CTI3_LAR_ADDR A:0x813fb0
y.create.l HWIO_QDSS_CTI3_LSR_ADDR A:0x813fb4
y.create.l HWIO_QDSS_CTI3_AUTHSTATUS_ADDR A:0x813fb8
y.create.l HWIO_QDSS_CTI3_DEVID_ADDR A:0x813fc8
y.create.l HWIO_QDSS_CTI3_DEVTYPE_ADDR A:0x813fcc
y.create.l HWIO_QDSS_CTI3_PERIPHID0_ADDR A:0x813fe0
y.create.l HWIO_QDSS_CTI3_PERIPHID1_ADDR A:0x813fe4
y.create.l HWIO_QDSS_CTI3_PERIPHID2_ADDR A:0x813fe8
y.create.l HWIO_QDSS_CTI3_PERIPHID3_ADDR A:0x813fec
y.create.l HWIO_QDSS_CTI3_PERIPHID4_ADDR A:0x813fd0
y.create.l HWIO_QDSS_CTI3_PERIPHID5_ADDR A:0x813fd4
y.create.l HWIO_QDSS_CTI3_PERIPHID6_ADDR A:0x813fd8
y.create.l HWIO_QDSS_CTI3_PERIPHID7_ADDR A:0x813fdc
y.create.l HWIO_QDSS_CTI3_COMPID0_ADDR A:0x813ff0
y.create.l HWIO_QDSS_CTI3_COMPID1_ADDR A:0x813ff4
y.create.l HWIO_QDSS_CTI3_COMPID2_ADDR A:0x813ff8
y.create.l HWIO_QDSS_CTI3_COMPID3_ADDR A:0x813ffc
y.create.l HWIO_QDSS_CTI4_CTICONTROL_ADDR A:0x814000
y.create.l HWIO_QDSS_CTI4_CTIINTACK_ADDR A:0x814010
y.create.l HWIO_QDSS_CTI4_CTIAPPSET_ADDR A:0x814014
y.create.l HWIO_QDSS_CTI4_CTIAPPCLEAR_ADDR A:0x814018
y.create.l HWIO_QDSS_CTI4_CTIAPPPULSE_ADDR A:0x81401c
y.create.l HWIO_QDSS_CTI4_CTIINEN0_ADDR A:0x814020
y.create.l HWIO_QDSS_CTI4_CTIINEN1_ADDR A:0x814024
y.create.l HWIO_QDSS_CTI4_CTIINEN2_ADDR A:0x814028
y.create.l HWIO_QDSS_CTI4_CTIINEN3_ADDR A:0x81402c
y.create.l HWIO_QDSS_CTI4_CTIINEN4_ADDR A:0x814030
y.create.l HWIO_QDSS_CTI4_CTIINEN5_ADDR A:0x814034
y.create.l HWIO_QDSS_CTI4_CTIINEN6_ADDR A:0x814038
y.create.l HWIO_QDSS_CTI4_CTIINEN7_ADDR A:0x81403c
y.create.l HWIO_QDSS_CTI4_CTIOUTEN0_ADDR A:0x8140a0
y.create.l HWIO_QDSS_CTI4_CTIOUTEN1_ADDR A:0x8140a4
y.create.l HWIO_QDSS_CTI4_CTIOUTEN2_ADDR A:0x8140a8
y.create.l HWIO_QDSS_CTI4_CTIOUTEN3_ADDR A:0x8140ac
y.create.l HWIO_QDSS_CTI4_CTIOUTEN4_ADDR A:0x8140b0
y.create.l HWIO_QDSS_CTI4_CTIOUTEN5_ADDR A:0x8140b4
y.create.l HWIO_QDSS_CTI4_CTIOUTEN6_ADDR A:0x8140b8
y.create.l HWIO_QDSS_CTI4_CTIOUTEN7_ADDR A:0x8140bc
y.create.l HWIO_QDSS_CTI4_CTITRIGINSTATUS_ADDR A:0x814130
y.create.l HWIO_QDSS_CTI4_CTITRIGOUTSTATUS_ADDR A:0x814134
y.create.l HWIO_QDSS_CTI4_CTICHINSTATUS_ADDR A:0x814138
y.create.l HWIO_QDSS_CTI4_CTICHOUTSTATUS_ADDR A:0x81413c
y.create.l HWIO_QDSS_CTI4_CTIGATE_ADDR A:0x814140
y.create.l HWIO_QDSS_CTI4_ASICCTL_ADDR A:0x814144
y.create.l HWIO_QDSS_CTI4_ITCHINACK_ADDR A:0x814edc
y.create.l HWIO_QDSS_CTI4_ITTRIGINACK_ADDR A:0x814ee0
y.create.l HWIO_QDSS_CTI4_ITCHOUT_ADDR A:0x814ee4
y.create.l HWIO_QDSS_CTI4_ITTRIGOUT_ADDR A:0x814ee8
y.create.l HWIO_QDSS_CTI4_ITCHOUTACK_ADDR A:0x814eec
y.create.l HWIO_QDSS_CTI4_ITTRIGOUTACK_ADDR A:0x814ef0
y.create.l HWIO_QDSS_CTI4_ITCHIN_ADDR A:0x814ef4
y.create.l HWIO_QDSS_CTI4_ITTRIGIN_ADDR A:0x814ef8
y.create.l HWIO_QDSS_CTI4_ITCTRL_ADDR A:0x814f00
y.create.l HWIO_QDSS_CTI4_CLAIMSET_ADDR A:0x814fa0
y.create.l HWIO_QDSS_CTI4_CLAIMCLR_ADDR A:0x814fa4
y.create.l HWIO_QDSS_CTI4_LAR_ADDR A:0x814fb0
y.create.l HWIO_QDSS_CTI4_LSR_ADDR A:0x814fb4
y.create.l HWIO_QDSS_CTI4_AUTHSTATUS_ADDR A:0x814fb8
y.create.l HWIO_QDSS_CTI4_DEVID_ADDR A:0x814fc8
y.create.l HWIO_QDSS_CTI4_DEVTYPE_ADDR A:0x814fcc
y.create.l HWIO_QDSS_CTI4_PERIPHID0_ADDR A:0x814fe0
y.create.l HWIO_QDSS_CTI4_PERIPHID1_ADDR A:0x814fe4
y.create.l HWIO_QDSS_CTI4_PERIPHID2_ADDR A:0x814fe8
y.create.l HWIO_QDSS_CTI4_PERIPHID3_ADDR A:0x814fec
y.create.l HWIO_QDSS_CTI4_PERIPHID4_ADDR A:0x814fd0
y.create.l HWIO_QDSS_CTI4_PERIPHID5_ADDR A:0x814fd4
y.create.l HWIO_QDSS_CTI4_PERIPHID6_ADDR A:0x814fd8
y.create.l HWIO_QDSS_CTI4_PERIPHID7_ADDR A:0x814fdc
y.create.l HWIO_QDSS_CTI4_COMPID0_ADDR A:0x814ff0
y.create.l HWIO_QDSS_CTI4_COMPID1_ADDR A:0x814ff4
y.create.l HWIO_QDSS_CTI4_COMPID2_ADDR A:0x814ff8
y.create.l HWIO_QDSS_CTI4_COMPID3_ADDR A:0x814ffc
y.create.l HWIO_QDSS_CTI5_CTICONTROL_ADDR A:0x815000
y.create.l HWIO_QDSS_CTI5_CTIINTACK_ADDR A:0x815010
y.create.l HWIO_QDSS_CTI5_CTIAPPSET_ADDR A:0x815014
y.create.l HWIO_QDSS_CTI5_CTIAPPCLEAR_ADDR A:0x815018
y.create.l HWIO_QDSS_CTI5_CTIAPPPULSE_ADDR A:0x81501c
y.create.l HWIO_QDSS_CTI5_CTIINEN0_ADDR A:0x815020
y.create.l HWIO_QDSS_CTI5_CTIINEN1_ADDR A:0x815024
y.create.l HWIO_QDSS_CTI5_CTIINEN2_ADDR A:0x815028
y.create.l HWIO_QDSS_CTI5_CTIINEN3_ADDR A:0x81502c
y.create.l HWIO_QDSS_CTI5_CTIINEN4_ADDR A:0x815030
y.create.l HWIO_QDSS_CTI5_CTIINEN5_ADDR A:0x815034
y.create.l HWIO_QDSS_CTI5_CTIINEN6_ADDR A:0x815038
y.create.l HWIO_QDSS_CTI5_CTIINEN7_ADDR A:0x81503c
y.create.l HWIO_QDSS_CTI5_CTIOUTEN0_ADDR A:0x8150a0
y.create.l HWIO_QDSS_CTI5_CTIOUTEN1_ADDR A:0x8150a4
y.create.l HWIO_QDSS_CTI5_CTIOUTEN2_ADDR A:0x8150a8
y.create.l HWIO_QDSS_CTI5_CTIOUTEN3_ADDR A:0x8150ac
y.create.l HWIO_QDSS_CTI5_CTIOUTEN4_ADDR A:0x8150b0
y.create.l HWIO_QDSS_CTI5_CTIOUTEN5_ADDR A:0x8150b4
y.create.l HWIO_QDSS_CTI5_CTIOUTEN6_ADDR A:0x8150b8
y.create.l HWIO_QDSS_CTI5_CTIOUTEN7_ADDR A:0x8150bc
y.create.l HWIO_QDSS_CTI5_CTITRIGINSTATUS_ADDR A:0x815130
y.create.l HWIO_QDSS_CTI5_CTITRIGOUTSTATUS_ADDR A:0x815134
y.create.l HWIO_QDSS_CTI5_CTICHINSTATUS_ADDR A:0x815138
y.create.l HWIO_QDSS_CTI5_CTICHOUTSTATUS_ADDR A:0x81513c
y.create.l HWIO_QDSS_CTI5_CTIGATE_ADDR A:0x815140
y.create.l HWIO_QDSS_CTI5_ASICCTL_ADDR A:0x815144
y.create.l HWIO_QDSS_CTI5_ITCHINACK_ADDR A:0x815edc
y.create.l HWIO_QDSS_CTI5_ITTRIGINACK_ADDR A:0x815ee0
y.create.l HWIO_QDSS_CTI5_ITCHOUT_ADDR A:0x815ee4
y.create.l HWIO_QDSS_CTI5_ITTRIGOUT_ADDR A:0x815ee8
y.create.l HWIO_QDSS_CTI5_ITCHOUTACK_ADDR A:0x815eec
y.create.l HWIO_QDSS_CTI5_ITTRIGOUTACK_ADDR A:0x815ef0
y.create.l HWIO_QDSS_CTI5_ITCHIN_ADDR A:0x815ef4
y.create.l HWIO_QDSS_CTI5_ITTRIGIN_ADDR A:0x815ef8
y.create.l HWIO_QDSS_CTI5_ITCTRL_ADDR A:0x815f00
y.create.l HWIO_QDSS_CTI5_CLAIMSET_ADDR A:0x815fa0
y.create.l HWIO_QDSS_CTI5_CLAIMCLR_ADDR A:0x815fa4
y.create.l HWIO_QDSS_CTI5_LAR_ADDR A:0x815fb0
y.create.l HWIO_QDSS_CTI5_LSR_ADDR A:0x815fb4
y.create.l HWIO_QDSS_CTI5_AUTHSTATUS_ADDR A:0x815fb8
y.create.l HWIO_QDSS_CTI5_DEVID_ADDR A:0x815fc8
y.create.l HWIO_QDSS_CTI5_DEVTYPE_ADDR A:0x815fcc
y.create.l HWIO_QDSS_CTI5_PERIPHID0_ADDR A:0x815fe0
y.create.l HWIO_QDSS_CTI5_PERIPHID1_ADDR A:0x815fe4
y.create.l HWIO_QDSS_CTI5_PERIPHID2_ADDR A:0x815fe8
y.create.l HWIO_QDSS_CTI5_PERIPHID3_ADDR A:0x815fec
y.create.l HWIO_QDSS_CTI5_PERIPHID4_ADDR A:0x815fd0
y.create.l HWIO_QDSS_CTI5_PERIPHID5_ADDR A:0x815fd4
y.create.l HWIO_QDSS_CTI5_PERIPHID6_ADDR A:0x815fd8
y.create.l HWIO_QDSS_CTI5_PERIPHID7_ADDR A:0x815fdc
y.create.l HWIO_QDSS_CTI5_COMPID0_ADDR A:0x815ff0
y.create.l HWIO_QDSS_CTI5_COMPID1_ADDR A:0x815ff4
y.create.l HWIO_QDSS_CTI5_COMPID2_ADDR A:0x815ff8
y.create.l HWIO_QDSS_CTI5_COMPID3_ADDR A:0x815ffc
y.create.l HWIO_QDSS_CTI6_CTICONTROL_ADDR A:0x816000
y.create.l HWIO_QDSS_CTI6_CTIINTACK_ADDR A:0x816010
y.create.l HWIO_QDSS_CTI6_CTIAPPSET_ADDR A:0x816014
y.create.l HWIO_QDSS_CTI6_CTIAPPCLEAR_ADDR A:0x816018
y.create.l HWIO_QDSS_CTI6_CTIAPPPULSE_ADDR A:0x81601c
y.create.l HWIO_QDSS_CTI6_CTIINEN0_ADDR A:0x816020
y.create.l HWIO_QDSS_CTI6_CTIINEN1_ADDR A:0x816024
y.create.l HWIO_QDSS_CTI6_CTIINEN2_ADDR A:0x816028
y.create.l HWIO_QDSS_CTI6_CTIINEN3_ADDR A:0x81602c
y.create.l HWIO_QDSS_CTI6_CTIINEN4_ADDR A:0x816030
y.create.l HWIO_QDSS_CTI6_CTIINEN5_ADDR A:0x816034
y.create.l HWIO_QDSS_CTI6_CTIINEN6_ADDR A:0x816038
y.create.l HWIO_QDSS_CTI6_CTIINEN7_ADDR A:0x81603c
y.create.l HWIO_QDSS_CTI6_CTIOUTEN0_ADDR A:0x8160a0
y.create.l HWIO_QDSS_CTI6_CTIOUTEN1_ADDR A:0x8160a4
y.create.l HWIO_QDSS_CTI6_CTIOUTEN2_ADDR A:0x8160a8
y.create.l HWIO_QDSS_CTI6_CTIOUTEN3_ADDR A:0x8160ac
y.create.l HWIO_QDSS_CTI6_CTIOUTEN4_ADDR A:0x8160b0
y.create.l HWIO_QDSS_CTI6_CTIOUTEN5_ADDR A:0x8160b4
y.create.l HWIO_QDSS_CTI6_CTIOUTEN6_ADDR A:0x8160b8
y.create.l HWIO_QDSS_CTI6_CTIOUTEN7_ADDR A:0x8160bc
y.create.l HWIO_QDSS_CTI6_CTITRIGINSTATUS_ADDR A:0x816130
y.create.l HWIO_QDSS_CTI6_CTITRIGOUTSTATUS_ADDR A:0x816134
y.create.l HWIO_QDSS_CTI6_CTICHINSTATUS_ADDR A:0x816138
y.create.l HWIO_QDSS_CTI6_CTICHOUTSTATUS_ADDR A:0x81613c
y.create.l HWIO_QDSS_CTI6_CTIGATE_ADDR A:0x816140
y.create.l HWIO_QDSS_CTI6_ASICCTL_ADDR A:0x816144
y.create.l HWIO_QDSS_CTI6_ITCHINACK_ADDR A:0x816edc
y.create.l HWIO_QDSS_CTI6_ITTRIGINACK_ADDR A:0x816ee0
y.create.l HWIO_QDSS_CTI6_ITCHOUT_ADDR A:0x816ee4
y.create.l HWIO_QDSS_CTI6_ITTRIGOUT_ADDR A:0x816ee8
y.create.l HWIO_QDSS_CTI6_ITCHOUTACK_ADDR A:0x816eec
y.create.l HWIO_QDSS_CTI6_ITTRIGOUTACK_ADDR A:0x816ef0
y.create.l HWIO_QDSS_CTI6_ITCHIN_ADDR A:0x816ef4
y.create.l HWIO_QDSS_CTI6_ITTRIGIN_ADDR A:0x816ef8
y.create.l HWIO_QDSS_CTI6_ITCTRL_ADDR A:0x816f00
y.create.l HWIO_QDSS_CTI6_CLAIMSET_ADDR A:0x816fa0
y.create.l HWIO_QDSS_CTI6_CLAIMCLR_ADDR A:0x816fa4
y.create.l HWIO_QDSS_CTI6_LAR_ADDR A:0x816fb0
y.create.l HWIO_QDSS_CTI6_LSR_ADDR A:0x816fb4
y.create.l HWIO_QDSS_CTI6_AUTHSTATUS_ADDR A:0x816fb8
y.create.l HWIO_QDSS_CTI6_DEVID_ADDR A:0x816fc8
y.create.l HWIO_QDSS_CTI6_DEVTYPE_ADDR A:0x816fcc
y.create.l HWIO_QDSS_CTI6_PERIPHID0_ADDR A:0x816fe0
y.create.l HWIO_QDSS_CTI6_PERIPHID1_ADDR A:0x816fe4
y.create.l HWIO_QDSS_CTI6_PERIPHID2_ADDR A:0x816fe8
y.create.l HWIO_QDSS_CTI6_PERIPHID3_ADDR A:0x816fec
y.create.l HWIO_QDSS_CTI6_PERIPHID4_ADDR A:0x816fd0
y.create.l HWIO_QDSS_CTI6_PERIPHID5_ADDR A:0x816fd4
y.create.l HWIO_QDSS_CTI6_PERIPHID6_ADDR A:0x816fd8
y.create.l HWIO_QDSS_CTI6_PERIPHID7_ADDR A:0x816fdc
y.create.l HWIO_QDSS_CTI6_COMPID0_ADDR A:0x816ff0
y.create.l HWIO_QDSS_CTI6_COMPID1_ADDR A:0x816ff4
y.create.l HWIO_QDSS_CTI6_COMPID2_ADDR A:0x816ff8
y.create.l HWIO_QDSS_CTI6_COMPID3_ADDR A:0x816ffc
y.create.l HWIO_QDSS_CTI7_CTICONTROL_ADDR A:0x817000
y.create.l HWIO_QDSS_CTI7_CTIINTACK_ADDR A:0x817010
y.create.l HWIO_QDSS_CTI7_CTIAPPSET_ADDR A:0x817014
y.create.l HWIO_QDSS_CTI7_CTIAPPCLEAR_ADDR A:0x817018
y.create.l HWIO_QDSS_CTI7_CTIAPPPULSE_ADDR A:0x81701c
y.create.l HWIO_QDSS_CTI7_CTIINEN0_ADDR A:0x817020
y.create.l HWIO_QDSS_CTI7_CTIINEN1_ADDR A:0x817024
y.create.l HWIO_QDSS_CTI7_CTIINEN2_ADDR A:0x817028
y.create.l HWIO_QDSS_CTI7_CTIINEN3_ADDR A:0x81702c
y.create.l HWIO_QDSS_CTI7_CTIINEN4_ADDR A:0x817030
y.create.l HWIO_QDSS_CTI7_CTIINEN5_ADDR A:0x817034
y.create.l HWIO_QDSS_CTI7_CTIINEN6_ADDR A:0x817038
y.create.l HWIO_QDSS_CTI7_CTIINEN7_ADDR A:0x81703c
y.create.l HWIO_QDSS_CTI7_CTIOUTEN0_ADDR A:0x8170a0
y.create.l HWIO_QDSS_CTI7_CTIOUTEN1_ADDR A:0x8170a4
y.create.l HWIO_QDSS_CTI7_CTIOUTEN2_ADDR A:0x8170a8
y.create.l HWIO_QDSS_CTI7_CTIOUTEN3_ADDR A:0x8170ac
y.create.l HWIO_QDSS_CTI7_CTIOUTEN4_ADDR A:0x8170b0
y.create.l HWIO_QDSS_CTI7_CTIOUTEN5_ADDR A:0x8170b4
y.create.l HWIO_QDSS_CTI7_CTIOUTEN6_ADDR A:0x8170b8
y.create.l HWIO_QDSS_CTI7_CTIOUTEN7_ADDR A:0x8170bc
y.create.l HWIO_QDSS_CTI7_CTITRIGINSTATUS_ADDR A:0x817130
y.create.l HWIO_QDSS_CTI7_CTITRIGOUTSTATUS_ADDR A:0x817134
y.create.l HWIO_QDSS_CTI7_CTICHINSTATUS_ADDR A:0x817138
y.create.l HWIO_QDSS_CTI7_CTICHOUTSTATUS_ADDR A:0x81713c
y.create.l HWIO_QDSS_CTI7_CTIGATE_ADDR A:0x817140
y.create.l HWIO_QDSS_CTI7_ASICCTL_ADDR A:0x817144
y.create.l HWIO_QDSS_CTI7_ITCHINACK_ADDR A:0x817edc
y.create.l HWIO_QDSS_CTI7_ITTRIGINACK_ADDR A:0x817ee0
y.create.l HWIO_QDSS_CTI7_ITCHOUT_ADDR A:0x817ee4
y.create.l HWIO_QDSS_CTI7_ITTRIGOUT_ADDR A:0x817ee8
y.create.l HWIO_QDSS_CTI7_ITCHOUTACK_ADDR A:0x817eec
y.create.l HWIO_QDSS_CTI7_ITTRIGOUTACK_ADDR A:0x817ef0
y.create.l HWIO_QDSS_CTI7_ITCHIN_ADDR A:0x817ef4
y.create.l HWIO_QDSS_CTI7_ITTRIGIN_ADDR A:0x817ef8
y.create.l HWIO_QDSS_CTI7_ITCTRL_ADDR A:0x817f00
y.create.l HWIO_QDSS_CTI7_CLAIMSET_ADDR A:0x817fa0
y.create.l HWIO_QDSS_CTI7_CLAIMCLR_ADDR A:0x817fa4
y.create.l HWIO_QDSS_CTI7_LAR_ADDR A:0x817fb0
y.create.l HWIO_QDSS_CTI7_LSR_ADDR A:0x817fb4
y.create.l HWIO_QDSS_CTI7_AUTHSTATUS_ADDR A:0x817fb8
y.create.l HWIO_QDSS_CTI7_DEVID_ADDR A:0x817fc8
y.create.l HWIO_QDSS_CTI7_DEVTYPE_ADDR A:0x817fcc
y.create.l HWIO_QDSS_CTI7_PERIPHID0_ADDR A:0x817fe0
y.create.l HWIO_QDSS_CTI7_PERIPHID1_ADDR A:0x817fe4
y.create.l HWIO_QDSS_CTI7_PERIPHID2_ADDR A:0x817fe8
y.create.l HWIO_QDSS_CTI7_PERIPHID3_ADDR A:0x817fec
y.create.l HWIO_QDSS_CTI7_PERIPHID4_ADDR A:0x817fd0
y.create.l HWIO_QDSS_CTI7_PERIPHID5_ADDR A:0x817fd4
y.create.l HWIO_QDSS_CTI7_PERIPHID6_ADDR A:0x817fd8
y.create.l HWIO_QDSS_CTI7_PERIPHID7_ADDR A:0x817fdc
y.create.l HWIO_QDSS_CTI7_COMPID0_ADDR A:0x817ff0
y.create.l HWIO_QDSS_CTI7_COMPID1_ADDR A:0x817ff4
y.create.l HWIO_QDSS_CTI7_COMPID2_ADDR A:0x817ff8
y.create.l HWIO_QDSS_CTI7_COMPID3_ADDR A:0x817ffc
y.create.l HWIO_QDSS_CTI8_CTICONTROL_ADDR A:0x818000
y.create.l HWIO_QDSS_CTI8_CTIINTACK_ADDR A:0x818010
y.create.l HWIO_QDSS_CTI8_CTIAPPSET_ADDR A:0x818014
y.create.l HWIO_QDSS_CTI8_CTIAPPCLEAR_ADDR A:0x818018
y.create.l HWIO_QDSS_CTI8_CTIAPPPULSE_ADDR A:0x81801c
y.create.l HWIO_QDSS_CTI8_CTIINEN0_ADDR A:0x818020
y.create.l HWIO_QDSS_CTI8_CTIINEN1_ADDR A:0x818024
y.create.l HWIO_QDSS_CTI8_CTIINEN2_ADDR A:0x818028
y.create.l HWIO_QDSS_CTI8_CTIINEN3_ADDR A:0x81802c
y.create.l HWIO_QDSS_CTI8_CTIINEN4_ADDR A:0x818030
y.create.l HWIO_QDSS_CTI8_CTIINEN5_ADDR A:0x818034
y.create.l HWIO_QDSS_CTI8_CTIINEN6_ADDR A:0x818038
y.create.l HWIO_QDSS_CTI8_CTIINEN7_ADDR A:0x81803c
y.create.l HWIO_QDSS_CTI8_CTIOUTEN0_ADDR A:0x8180a0
y.create.l HWIO_QDSS_CTI8_CTIOUTEN1_ADDR A:0x8180a4
y.create.l HWIO_QDSS_CTI8_CTIOUTEN2_ADDR A:0x8180a8
y.create.l HWIO_QDSS_CTI8_CTIOUTEN3_ADDR A:0x8180ac
y.create.l HWIO_QDSS_CTI8_CTIOUTEN4_ADDR A:0x8180b0
y.create.l HWIO_QDSS_CTI8_CTIOUTEN5_ADDR A:0x8180b4
y.create.l HWIO_QDSS_CTI8_CTIOUTEN6_ADDR A:0x8180b8
y.create.l HWIO_QDSS_CTI8_CTIOUTEN7_ADDR A:0x8180bc
y.create.l HWIO_QDSS_CTI8_CTITRIGINSTATUS_ADDR A:0x818130
y.create.l HWIO_QDSS_CTI8_CTITRIGOUTSTATUS_ADDR A:0x818134
y.create.l HWIO_QDSS_CTI8_CTICHINSTATUS_ADDR A:0x818138
y.create.l HWIO_QDSS_CTI8_CTICHOUTSTATUS_ADDR A:0x81813c
y.create.l HWIO_QDSS_CTI8_CTIGATE_ADDR A:0x818140
y.create.l HWIO_QDSS_CTI8_ASICCTL_ADDR A:0x818144
y.create.l HWIO_QDSS_CTI8_ITCHINACK_ADDR A:0x818edc
y.create.l HWIO_QDSS_CTI8_ITTRIGINACK_ADDR A:0x818ee0
y.create.l HWIO_QDSS_CTI8_ITCHOUT_ADDR A:0x818ee4
y.create.l HWIO_QDSS_CTI8_ITTRIGOUT_ADDR A:0x818ee8
y.create.l HWIO_QDSS_CTI8_ITCHOUTACK_ADDR A:0x818eec
y.create.l HWIO_QDSS_CTI8_ITTRIGOUTACK_ADDR A:0x818ef0
y.create.l HWIO_QDSS_CTI8_ITCHIN_ADDR A:0x818ef4
y.create.l HWIO_QDSS_CTI8_ITTRIGIN_ADDR A:0x818ef8
y.create.l HWIO_QDSS_CTI8_ITCTRL_ADDR A:0x818f00
y.create.l HWIO_QDSS_CTI8_CLAIMSET_ADDR A:0x818fa0
y.create.l HWIO_QDSS_CTI8_CLAIMCLR_ADDR A:0x818fa4
y.create.l HWIO_QDSS_CTI8_LAR_ADDR A:0x818fb0
y.create.l HWIO_QDSS_CTI8_LSR_ADDR A:0x818fb4
y.create.l HWIO_QDSS_CTI8_AUTHSTATUS_ADDR A:0x818fb8
y.create.l HWIO_QDSS_CTI8_DEVID_ADDR A:0x818fc8
y.create.l HWIO_QDSS_CTI8_DEVTYPE_ADDR A:0x818fcc
y.create.l HWIO_QDSS_CTI8_PERIPHID0_ADDR A:0x818fe0
y.create.l HWIO_QDSS_CTI8_PERIPHID1_ADDR A:0x818fe4
y.create.l HWIO_QDSS_CTI8_PERIPHID2_ADDR A:0x818fe8
y.create.l HWIO_QDSS_CTI8_PERIPHID3_ADDR A:0x818fec
y.create.l HWIO_QDSS_CTI8_PERIPHID4_ADDR A:0x818fd0
y.create.l HWIO_QDSS_CTI8_PERIPHID5_ADDR A:0x818fd4
y.create.l HWIO_QDSS_CTI8_PERIPHID6_ADDR A:0x818fd8
y.create.l HWIO_QDSS_CTI8_PERIPHID7_ADDR A:0x818fdc
y.create.l HWIO_QDSS_CTI8_COMPID0_ADDR A:0x818ff0
y.create.l HWIO_QDSS_CTI8_COMPID1_ADDR A:0x818ff4
y.create.l HWIO_QDSS_CTI8_COMPID2_ADDR A:0x818ff8
y.create.l HWIO_QDSS_CTI8_COMPID3_ADDR A:0x818ffc
y.create.l HWIO_QDSS_CSTPIU_SUPPORTED_PORT_SIZES_ADDR A:0x820000
y.create.l HWIO_QDSS_CSTPIU_CURRENT_PORT_SIZE_ADDR A:0x820004
y.create.l HWIO_QDSS_CSTPIU_SUPPORTED_TRIGGER_MODES_ADDR A:0x820100
y.create.l HWIO_QDSS_CSTPIU_TRIGGER_COUNTER_VALUE_ADDR A:0x820104
y.create.l HWIO_QDSS_CSTPIU_TRIGGER_MULTIPLIER_ADDR A:0x820108
y.create.l HWIO_QDSS_CSTPIU_SUPPORTED_TEST_PATTERN_MODES_ADDR A:0x820200
y.create.l HWIO_QDSS_CSTPIU_CURRENT_TEST_PATTERN_MODE_ADDR A:0x820204
y.create.l HWIO_QDSS_CSTPIU_TPRCR_ADDR A:0x820208
y.create.l HWIO_QDSS_CSTPIU_FFSR_ADDR A:0x820300
y.create.l HWIO_QDSS_CSTPIU_FFCR_ADDR A:0x820304
y.create.l HWIO_QDSS_CSTPIU_FSCR_ADDR A:0x820308
y.create.l HWIO_QDSS_CSTPIU_EXTCTL_IN_PORT_ADDR A:0x820400
y.create.l HWIO_QDSS_CSTPIU_EXTCTL_OUT_PORT_ADDR A:0x820404
y.create.l HWIO_QDSS_CSTPIU_ITTRFLINACK_ADDR A:0x820ee4
y.create.l HWIO_QDSS_CSTPIU_ITTRFLIN_ADDR A:0x820ee8
y.create.l HWIO_QDSS_CSTPIU_ITATBDATA0_ADDR A:0x820eec
y.create.l HWIO_QDSS_CSTPIU_ITATBCTR2_ADDR A:0x820ef0
y.create.l HWIO_QDSS_CSTPIU_ITATBCTR1_ADDR A:0x820ef4
y.create.l HWIO_QDSS_CSTPIU_ITATBCTR0_ADDR A:0x820ef8
y.create.l HWIO_QDSS_CSTPIU_ITCTRL_ADDR A:0x820f00
y.create.l HWIO_QDSS_CSTPIU_CLAIMSET_ADDR A:0x820fa0
y.create.l HWIO_QDSS_CSTPIU_CLAIMCLR_ADDR A:0x820fa4
y.create.l HWIO_QDSS_CSTPIU_LAR_ADDR A:0x820fb0
y.create.l HWIO_QDSS_CSTPIU_LSR_ADDR A:0x820fb4
y.create.l HWIO_QDSS_CSTPIU_AUTHSTATUS_ADDR A:0x820fb8
y.create.l HWIO_QDSS_CSTPIU_DEVID_ADDR A:0x820fc8
y.create.l HWIO_QDSS_CSTPIU_DEVTYPE_ADDR A:0x820fcc
y.create.l HWIO_QDSS_CSTPIU_PERIPHID0_ADDR A:0x820fe0
y.create.l HWIO_QDSS_CSTPIU_PERIPHID1_ADDR A:0x820fe4
y.create.l HWIO_QDSS_CSTPIU_PERIPHID2_ADDR A:0x820fe8
y.create.l HWIO_QDSS_CSTPIU_PERIPHID3_ADDR A:0x820fec
y.create.l HWIO_QDSS_CSTPIU_PERIPHID4_ADDR A:0x820fd0
y.create.l HWIO_QDSS_CSTPIU_PERIPHID5_ADDR A:0x820fd4
y.create.l HWIO_QDSS_CSTPIU_PERIPHID6_ADDR A:0x820fd8
y.create.l HWIO_QDSS_CSTPIU_PERIPHID7_ADDR A:0x820fdc
y.create.l HWIO_QDSS_CSTPIU_COMPID0_ADDR A:0x820ff0
y.create.l HWIO_QDSS_CSTPIU_COMPID1_ADDR A:0x820ff4
y.create.l HWIO_QDSS_CSTPIU_COMPID2_ADDR A:0x820ff8
y.create.l HWIO_QDSS_CSTPIU_COMPID3_ADDR A:0x820ffc
y.create.l HWIO_QDSS_IN_FUN0_CTRL_REG_ADDR A:0x821000
y.create.l HWIO_QDSS_IN_FUN0_PRIORITY_CTRL_REG_ADDR A:0x821004
y.create.l HWIO_QDSS_IN_FUN0_ITATBDATA0_ADDR A:0x821eec
y.create.l HWIO_QDSS_IN_FUN0_ITATBCTR2_ADDR A:0x821ef0
y.create.l HWIO_QDSS_IN_FUN0_ITATBCTR1_ADDR A:0x821ef4
y.create.l HWIO_QDSS_IN_FUN0_ITATBCTR0_ADDR A:0x821ef8
y.create.l HWIO_QDSS_IN_FUN0_ITCTRL_ADDR A:0x821f00
y.create.l HWIO_QDSS_IN_FUN0_CLAIMSET_ADDR A:0x821fa0
y.create.l HWIO_QDSS_IN_FUN0_CLAIMCLR_ADDR A:0x821fa4
y.create.l HWIO_QDSS_IN_FUN0_LOCKACCESS_ADDR A:0x821fb0
y.create.l HWIO_QDSS_IN_FUN0_LOCKSTATUS_ADDR A:0x821fb4
y.create.l HWIO_QDSS_IN_FUN0_AUTHSTATUS_ADDR A:0x821fb8
y.create.l HWIO_QDSS_IN_FUN0_DEVID_ADDR A:0x821fc8
y.create.l HWIO_QDSS_IN_FUN0_DEVTYPE_ADDR A:0x821fcc
y.create.l HWIO_QDSS_IN_FUN0_PERIPHID0_ADDR A:0x821fe0
y.create.l HWIO_QDSS_IN_FUN0_PERIPHID1_ADDR A:0x821fe4
y.create.l HWIO_QDSS_IN_FUN0_PERIPHID2_ADDR A:0x821fe8
y.create.l HWIO_QDSS_IN_FUN0_PERIPHID3_ADDR A:0x821fec
y.create.l HWIO_QDSS_IN_FUN0_PERIPHID4_ADDR A:0x821fd0
y.create.l HWIO_QDSS_IN_FUN0_PERIPHID5_ADDR A:0x821fd4
y.create.l HWIO_QDSS_IN_FUN0_PERIPHID6_ADDR A:0x821fd8
y.create.l HWIO_QDSS_IN_FUN0_PERIPHID7_ADDR A:0x821fdc
y.create.l HWIO_QDSS_IN_FUN0_COMPID0_ADDR A:0x821ff0
y.create.l HWIO_QDSS_IN_FUN0_COMPID1_ADDR A:0x821ff4
y.create.l HWIO_QDSS_IN_FUN0_COMPID2_ADDR A:0x821ff8
y.create.l HWIO_QDSS_IN_FUN0_COMPID3_ADDR A:0x821ffc
y.create.l HWIO_QDSS_REPL64_IDFILTER0_ADDR A:0x824000
y.create.l HWIO_QDSS_REPL64_IDFILTER1_ADDR A:0x824004
y.create.l HWIO_QDSS_REPL64_ITATBCTR0_ADDR A:0x824efc
y.create.l HWIO_QDSS_REPL64_ITATBCTR1_ADDR A:0x824ef8
y.create.l HWIO_QDSS_REPL64_ITCTRL_ADDR A:0x824f00
y.create.l HWIO_QDSS_REPL64_CLAIMSET_ADDR A:0x824fa0
y.create.l HWIO_QDSS_REPL64_CLAIMCLR_ADDR A:0x824fa4
y.create.l HWIO_QDSS_REPL64_LAR_ADDR A:0x824fb0
y.create.l HWIO_QDSS_REPL64_LSR_ADDR A:0x824fb4
y.create.l HWIO_QDSS_REPL64_AUTHSTATUS_ADDR A:0x824fb8
y.create.l HWIO_QDSS_REPL64_DEVID_ADDR A:0x824fc8
y.create.l HWIO_QDSS_REPL64_DEVTYPE_ADDR A:0x824fcc
y.create.l HWIO_QDSS_REPL64_PIDR0_ADDR A:0x824fe0
y.create.l HWIO_QDSS_REPL64_PIDR1_ADDR A:0x824fe4
y.create.l HWIO_QDSS_REPL64_PIDR2_ADDR A:0x824fe8
y.create.l HWIO_QDSS_REPL64_PIDR3_ADDR A:0x824fec
y.create.l HWIO_QDSS_REPL64_PIDR4_ADDR A:0x824fd0
y.create.l HWIO_QDSS_REPL64_PIDR5_ADDR A:0x824fd4
y.create.l HWIO_QDSS_REPL64_PIDR6_ADDR A:0x824fd8
y.create.l HWIO_QDSS_REPL64_PIDR7_ADDR A:0x824fdc
y.create.l HWIO_QDSS_REPL64_CIDR0_ADDR A:0x824ff0
y.create.l HWIO_QDSS_REPL64_CIDR1_ADDR A:0x824ff4
y.create.l HWIO_QDSS_REPL64_CIDR2_ADDR A:0x824ff8
y.create.l HWIO_QDSS_REPL64_CIDR3_ADDR A:0x824ffc
y.create.l HWIO_QDSS_ETFETB_RSZ_ADDR A:0x825004
y.create.l HWIO_QDSS_ETFETB_STS_ADDR A:0x82500c
y.create.l HWIO_QDSS_ETFETB_RRD_ADDR A:0x825010
y.create.l HWIO_QDSS_ETFETB_RRP_ADDR A:0x825014
y.create.l HWIO_QDSS_ETFETB_RWP_ADDR A:0x825018
y.create.l HWIO_QDSS_ETFETB_TRG_ADDR A:0x82501c
y.create.l HWIO_QDSS_ETFETB_CTL_ADDR A:0x825020
y.create.l HWIO_QDSS_ETFETB_RWD_ADDR A:0x825024
y.create.l HWIO_QDSS_ETFETB_MODE_ADDR A:0x825028
y.create.l HWIO_QDSS_ETFETB_LBUFLEVEL_ADDR A:0x82502c
y.create.l HWIO_QDSS_ETFETB_CBUFLEVEL_ADDR A:0x825030
y.create.l HWIO_QDSS_ETFETB_BUFWM_ADDR A:0x825034
y.create.l HWIO_QDSS_ETFETB_FFSR_ADDR A:0x825300
y.create.l HWIO_QDSS_ETFETB_FFCR_ADDR A:0x825304
y.create.l HWIO_QDSS_ETFETB_PSCR_ADDR A:0x825308
y.create.l HWIO_QDSS_ETFETB_ITATBMDATA0_ADDR A:0x825ed0
y.create.l HWIO_QDSS_ETFETB_ITATBMCTR2_ADDR A:0x825ed4
y.create.l HWIO_QDSS_ETFETB_ITATBMCTR1_ADDR A:0x825ed8
y.create.l HWIO_QDSS_ETFETB_ITATBMCTR0_ADDR A:0x825edc
y.create.l HWIO_QDSS_ETFETB_ITMISCOP0_ADDR A:0x825ee0
y.create.l HWIO_QDSS_ETFETB_ITTRFLIN_ADDR A:0x825ee8
y.create.l HWIO_QDSS_ETFETB_ITATBDATA0_ADDR A:0x825eec
y.create.l HWIO_QDSS_ETFETB_ITATBCTR2_ADDR A:0x825ef0
y.create.l HWIO_QDSS_ETFETB_ITATBCTR1_ADDR A:0x825ef4
y.create.l HWIO_QDSS_ETFETB_ITATBCTR0_ADDR A:0x825ef8
y.create.l HWIO_QDSS_ETFETB_ITCTRL_ADDR A:0x825f00
y.create.l HWIO_QDSS_ETFETB_CLAIMSET_ADDR A:0x825fa0
y.create.l HWIO_QDSS_ETFETB_CLAIMCLR_ADDR A:0x825fa4
y.create.l HWIO_QDSS_ETFETB_LAR_ADDR A:0x825fb0
y.create.l HWIO_QDSS_ETFETB_LSR_ADDR A:0x825fb4
y.create.l HWIO_QDSS_ETFETB_AUTHSTATUS_ADDR A:0x825fb8
y.create.l HWIO_QDSS_ETFETB_DEVID_ADDR A:0x825fc8
y.create.l HWIO_QDSS_ETFETB_DEVTYPE_ADDR A:0x825fcc
y.create.l HWIO_QDSS_ETFETB_PERIPHID0_ADDR A:0x825fe0
y.create.l HWIO_QDSS_ETFETB_PERIPHID1_ADDR A:0x825fe4
y.create.l HWIO_QDSS_ETFETB_PERIPHID2_ADDR A:0x825fe8
y.create.l HWIO_QDSS_ETFETB_PERIPHID3_ADDR A:0x825fec
y.create.l HWIO_QDSS_ETFETB_PERIPHID4_ADDR A:0x825fd0
y.create.l HWIO_QDSS_ETFETB_PERIPHID5_ADDR A:0x825fd4
y.create.l HWIO_QDSS_ETFETB_PERIPHID6_ADDR A:0x825fd8
y.create.l HWIO_QDSS_ETFETB_PERIPHID7_ADDR A:0x825fdc
y.create.l HWIO_QDSS_ETFETB_COMPID0_ADDR A:0x825ff0
y.create.l HWIO_QDSS_ETFETB_COMPID1_ADDR A:0x825ff4
y.create.l HWIO_QDSS_ETFETB_COMPID2_ADDR A:0x825ff8
y.create.l HWIO_QDSS_ETFETB_COMPID3_ADDR A:0x825ffc
y.create.l HWIO_QDSS_ETR_RSZ_ADDR A:0x826004
y.create.l HWIO_QDSS_ETR_STS_ADDR A:0x82600c
y.create.l HWIO_QDSS_ETR_RRD_ADDR A:0x826010
y.create.l HWIO_QDSS_ETR_RRP_ADDR A:0x826014
y.create.l HWIO_QDSS_ETR_RWP_ADDR A:0x826018
y.create.l HWIO_QDSS_ETR_TRG_ADDR A:0x82601c
y.create.l HWIO_QDSS_ETR_CTL_ADDR A:0x826020
y.create.l HWIO_QDSS_ETR_RWD_ADDR A:0x826024
y.create.l HWIO_QDSS_ETR_MODE_ADDR A:0x826028
y.create.l HWIO_QDSS_ETR_LBUFLEVEL_ADDR A:0x82602c
y.create.l HWIO_QDSS_ETR_CBUFLEVEL_ADDR A:0x826030
y.create.l HWIO_QDSS_ETR_BUFWM_ADDR A:0x826034
y.create.l HWIO_QDSS_ETR_RRPHI_ADDR A:0x826038
y.create.l HWIO_QDSS_ETR_RWPHI_ADDR A:0x82603c
y.create.l HWIO_QDSS_ETR_AXICTL_ADDR A:0x826110
y.create.l HWIO_QDSS_ETR_DBALO_ADDR A:0x826118
y.create.l HWIO_QDSS_ETR_DBAHI_ADDR A:0x82611c
y.create.l HWIO_QDSS_ETR_FFSR_ADDR A:0x826300
y.create.l HWIO_QDSS_ETR_FFCR_ADDR A:0x826304
y.create.l HWIO_QDSS_ETR_PSCR_ADDR A:0x826308
y.create.l HWIO_QDSS_ETR_ITMISCOP0_ADDR A:0x826ee0
y.create.l HWIO_QDSS_ETR_ITTRFLIN_ADDR A:0x826ee8
y.create.l HWIO_QDSS_ETR_ITATBDATA0_ADDR A:0x826eec
y.create.l HWIO_QDSS_ETR_ITATBCTR2_ADDR A:0x826ef0
y.create.l HWIO_QDSS_ETR_ITATBCTR1_ADDR A:0x826ef4
y.create.l HWIO_QDSS_ETR_ITATBCTR0_ADDR A:0x826ef8
y.create.l HWIO_QDSS_ETR_ITCTRL_ADDR A:0x826f00
y.create.l HWIO_QDSS_ETR_CLAIMSET_ADDR A:0x826fa0
y.create.l HWIO_QDSS_ETR_CLAIMCLR_ADDR A:0x826fa4
y.create.l HWIO_QDSS_ETR_LAR_ADDR A:0x826fb0
y.create.l HWIO_QDSS_ETR_LSR_ADDR A:0x826fb4
y.create.l HWIO_QDSS_ETR_AUTHSTATUS_ADDR A:0x826fb8
y.create.l HWIO_QDSS_ETR_DEVID_ADDR A:0x826fc8
y.create.l HWIO_QDSS_ETR_DEVTYPE_ADDR A:0x826fcc
y.create.l HWIO_QDSS_ETR_PERIPHID0_ADDR A:0x826fe0
y.create.l HWIO_QDSS_ETR_PERIPHID1_ADDR A:0x826fe4
y.create.l HWIO_QDSS_ETR_PERIPHID2_ADDR A:0x826fe8
y.create.l HWIO_QDSS_ETR_PERIPHID3_ADDR A:0x826fec
y.create.l HWIO_QDSS_ETR_PERIPHID4_ADDR A:0x826fd0
y.create.l HWIO_QDSS_ETR_PERIPHID5_ADDR A:0x826fd4
y.create.l HWIO_QDSS_ETR_PERIPHID6_ADDR A:0x826fd8
y.create.l HWIO_QDSS_ETR_PERIPHID7_ADDR A:0x826fdc
y.create.l HWIO_QDSS_ETR_COMPID0_ADDR A:0x826ff0
y.create.l HWIO_QDSS_ETR_COMPID1_ADDR A:0x826ff4
y.create.l HWIO_QDSS_ETR_COMPID2_ADDR A:0x826ff8
y.create.l HWIO_QDSS_ETR_COMPID3_ADDR A:0x826ffc
y.create.l HWIO_QDSS_NDPBAM_BAM_CTRL_ADDR A:0x884000
y.create.l HWIO_QDSS_NDPBAM_BAM_TIMER_ADDR A:0x884040
y.create.l HWIO_QDSS_NDPBAM_BAM_TIMER_CTRL_ADDR A:0x884044
y.create.l HWIO_QDSS_NDPBAM_BAM_DESC_CNT_TRSHLD_ADDR A:0x884008
y.create.l HWIO_QDSS_NDPBAM_BAM_IRQ_STTS_ADDR A:0x884014
y.create.l HWIO_QDSS_NDPBAM_BAM_IRQ_CLR_ADDR A:0x884018
y.create.l HWIO_QDSS_NDPBAM_BAM_IRQ_EN_ADDR A:0x88401c
y.create.l HWIO_QDSS_NDPBAM_BAM_CNFG_BITS_ADDR A:0x88407c
y.create.l HWIO_QDSS_NDPBAM_BAM_REVISION_ADDR A:0x885000
y.create.l HWIO_QDSS_NDPBAM_BAM_SW_VERSION_ADDR A:0x885004
y.create.l HWIO_QDSS_NDPBAM_BAM_NUM_PIPES_ADDR A:0x885008
y.create.l HWIO_QDSS_NDPBAM_BAM_TEST_BUS_SEL_ADDR A:0x885010
y.create.l HWIO_QDSS_NDPBAM_BAM_TEST_BUS_REG_ADDR A:0x885014
y.create.l HWIO_QDSS_NDPBAM_BAM_AHB_MASTER_ERR_CTRLS_ADDR A:0x885024
y.create.l HWIO_QDSS_NDPBAM_BAM_AHB_MASTER_ERR_ADDR_ADDR A:0x885028
y.create.l HWIO_QDSS_NDPBAM_BAM_AHB_MASTER_ERR_DATA_ADDR A:0x88502c
y.create.l HWIO_QDSS_NDPBAM_BAM_AHB_MASTER_ERR_ADDR_LSB_ADDR A:0x885100
y.create.l HWIO_QDSS_NDPBAM_BAM_AHB_MASTER_ERR_ADDR_MSB_ADDR A:0x885104
y.create.l HWIO_QDSS_NDPBAM_BAM_TRUST_REG_ADDR A:0x886000
y.create.l HWIO_QDSS_NDPBAM_BAM_P_TRUST_REG0_ADDR A:0x886020
y.create.l HWIO_QDSS_NDPBAM_BAM_P_TRUST_REG1_ADDR A:0x886024
y.create.l HWIO_QDSS_NDPBAM_BAM_IRQ_SRCS_EE0_ADDR A:0x887000
y.create.l HWIO_QDSS_NDPBAM_BAM_IRQ_SRCS_EE1_ADDR A:0x888000
y.create.l HWIO_QDSS_NDPBAM_BAM_IRQ_SRCS_EE2_ADDR A:0x889000
y.create.l HWIO_QDSS_NDPBAM_BAM_IRQ_SRCS_EE3_ADDR A:0x88a000
y.create.l HWIO_QDSS_NDPBAM_BAM_IRQ_SRCS_EE4_ADDR A:0x88b000
y.create.l HWIO_QDSS_NDPBAM_BAM_IRQ_SRCS_EE5_ADDR A:0x88c000
y.create.l HWIO_QDSS_NDPBAM_BAM_IRQ_SRCS_EE6_ADDR A:0x88d000
y.create.l HWIO_QDSS_NDPBAM_BAM_IRQ_SRCS_EE7_ADDR A:0x88e000
y.create.l HWIO_QDSS_NDPBAM_BAM_IRQ_SRCS_MSK_EE0_ADDR A:0x887004
y.create.l HWIO_QDSS_NDPBAM_BAM_IRQ_SRCS_MSK_EE1_ADDR A:0x888004
y.create.l HWIO_QDSS_NDPBAM_BAM_IRQ_SRCS_MSK_EE2_ADDR A:0x889004
y.create.l HWIO_QDSS_NDPBAM_BAM_IRQ_SRCS_MSK_EE3_ADDR A:0x88a004
y.create.l HWIO_QDSS_NDPBAM_BAM_IRQ_SRCS_MSK_EE4_ADDR A:0x88b004
y.create.l HWIO_QDSS_NDPBAM_BAM_IRQ_SRCS_MSK_EE5_ADDR A:0x88c004
y.create.l HWIO_QDSS_NDPBAM_BAM_IRQ_SRCS_MSK_EE6_ADDR A:0x88d004
y.create.l HWIO_QDSS_NDPBAM_BAM_IRQ_SRCS_MSK_EE7_ADDR A:0x88e004
y.create.l HWIO_QDSS_NDPBAM_BAM_IRQ_SRCS_UNMASKED_EE0_ADDR A:0x887008
y.create.l HWIO_QDSS_NDPBAM_BAM_IRQ_SRCS_UNMASKED_EE1_ADDR A:0x888008
y.create.l HWIO_QDSS_NDPBAM_BAM_IRQ_SRCS_UNMASKED_EE2_ADDR A:0x889008
y.create.l HWIO_QDSS_NDPBAM_BAM_IRQ_SRCS_UNMASKED_EE3_ADDR A:0x88a008
y.create.l HWIO_QDSS_NDPBAM_BAM_IRQ_SRCS_UNMASKED_EE4_ADDR A:0x88b008
y.create.l HWIO_QDSS_NDPBAM_BAM_IRQ_SRCS_UNMASKED_EE5_ADDR A:0x88c008
y.create.l HWIO_QDSS_NDPBAM_BAM_IRQ_SRCS_UNMASKED_EE6_ADDR A:0x88d008
y.create.l HWIO_QDSS_NDPBAM_BAM_IRQ_SRCS_UNMASKED_EE7_ADDR A:0x88e008
y.create.l HWIO_QDSS_NDPBAM_BAM_PIPE_ATTR_EE0_ADDR A:0x88700c
y.create.l HWIO_QDSS_NDPBAM_BAM_PIPE_ATTR_EE1_ADDR A:0x88800c
y.create.l HWIO_QDSS_NDPBAM_BAM_PIPE_ATTR_EE2_ADDR A:0x88900c
y.create.l HWIO_QDSS_NDPBAM_BAM_PIPE_ATTR_EE3_ADDR A:0x88a00c
y.create.l HWIO_QDSS_NDPBAM_BAM_PIPE_ATTR_EE4_ADDR A:0x88b00c
y.create.l HWIO_QDSS_NDPBAM_BAM_PIPE_ATTR_EE5_ADDR A:0x88c00c
y.create.l HWIO_QDSS_NDPBAM_BAM_PIPE_ATTR_EE6_ADDR A:0x88d00c
y.create.l HWIO_QDSS_NDPBAM_BAM_PIPE_ATTR_EE7_ADDR A:0x88e00c
y.create.l HWIO_QDSS_NDPBAM_BAM_IRQ_SRCS_ADDR A:0x887010
y.create.l HWIO_QDSS_NDPBAM_BAM_IRQ_SRCS_MSK_ADDR A:0x887014
y.create.l HWIO_QDSS_NDPBAM_BAM_IRQ_SRCS_UNMASKED_ADDR A:0x887018
y.create.l HWIO_QDSS_NDPBAM_BAM_P_CTRL0_ADDR A:0x897000
y.create.l HWIO_QDSS_NDPBAM_BAM_P_CTRL1_ADDR A:0x898000
y.create.l HWIO_QDSS_NDPBAM_BAM_P_RST0_ADDR A:0x897004
y.create.l HWIO_QDSS_NDPBAM_BAM_P_RST1_ADDR A:0x898004
y.create.l HWIO_QDSS_NDPBAM_BAM_P_HALT0_ADDR A:0x897008
y.create.l HWIO_QDSS_NDPBAM_BAM_P_HALT1_ADDR A:0x898008
y.create.l HWIO_QDSS_NDPBAM_BAM_P_IRQ_STTS0_ADDR A:0x897010
y.create.l HWIO_QDSS_NDPBAM_BAM_P_IRQ_STTS1_ADDR A:0x898010
y.create.l HWIO_QDSS_NDPBAM_BAM_P_IRQ_CLR0_ADDR A:0x897014
y.create.l HWIO_QDSS_NDPBAM_BAM_P_IRQ_CLR1_ADDR A:0x898014
y.create.l HWIO_QDSS_NDPBAM_BAM_P_IRQ_EN0_ADDR A:0x897018
y.create.l HWIO_QDSS_NDPBAM_BAM_P_IRQ_EN1_ADDR A:0x898018
y.create.l HWIO_QDSS_NDPBAM_BAM_P_TIMER0_ADDR A:0x89701c
y.create.l HWIO_QDSS_NDPBAM_BAM_P_TIMER1_ADDR A:0x89801c
y.create.l HWIO_QDSS_NDPBAM_BAM_P_TIMER_CTRL0_ADDR A:0x897020
y.create.l HWIO_QDSS_NDPBAM_BAM_P_TIMER_CTRL1_ADDR A:0x898020
y.create.l HWIO_QDSS_NDPBAM_BAM_P_PRDCR_SDBND0_ADDR A:0x897024
y.create.l HWIO_QDSS_NDPBAM_BAM_P_PRDCR_SDBND1_ADDR A:0x898024
y.create.l HWIO_QDSS_NDPBAM_BAM_P_CNSMR_SDBND0_ADDR A:0x897028
y.create.l HWIO_QDSS_NDPBAM_BAM_P_CNSMR_SDBND1_ADDR A:0x898028
y.create.l HWIO_QDSS_NDPBAM_BAM_P_SW_OFSTS0_ADDR A:0x897800
y.create.l HWIO_QDSS_NDPBAM_BAM_P_SW_OFSTS1_ADDR A:0x898800
y.create.l HWIO_QDSS_NDPBAM_BAM_P_AU_PSM_CNTXT_1_0_ADDR A:0x897804
y.create.l HWIO_QDSS_NDPBAM_BAM_P_AU_PSM_CNTXT_1_1_ADDR A:0x898804
y.create.l HWIO_QDSS_NDPBAM_BAM_P_PSM_CNTXT_2_0_ADDR A:0x897808
y.create.l HWIO_QDSS_NDPBAM_BAM_P_PSM_CNTXT_2_1_ADDR A:0x898808
y.create.l HWIO_QDSS_NDPBAM_BAM_P_PSM_CNTXT_3_0_ADDR A:0x89780c
y.create.l HWIO_QDSS_NDPBAM_BAM_P_PSM_CNTXT_3_1_ADDR A:0x89880c
y.create.l HWIO_QDSS_NDPBAM_BAM_P_PSM_CNTXT_4_0_ADDR A:0x897810
y.create.l HWIO_QDSS_NDPBAM_BAM_P_PSM_CNTXT_4_1_ADDR A:0x898810
y.create.l HWIO_QDSS_NDPBAM_BAM_P_PSM_CNTXT_5_0_ADDR A:0x897814
y.create.l HWIO_QDSS_NDPBAM_BAM_P_PSM_CNTXT_5_1_ADDR A:0x898814
y.create.l HWIO_QDSS_NDPBAM_BAM_P_EVNT_REG0_ADDR A:0x897818
y.create.l HWIO_QDSS_NDPBAM_BAM_P_EVNT_REG1_ADDR A:0x898818
y.create.l HWIO_QDSS_NDPBAM_BAM_P_DESC_FIFO_ADDR0_ADDR A:0x89781c
y.create.l HWIO_QDSS_NDPBAM_BAM_P_DESC_FIFO_ADDR1_ADDR A:0x89881c
y.create.l HWIO_QDSS_NDPBAM_BAM_P_FIFO_SIZES0_ADDR A:0x897820
y.create.l HWIO_QDSS_NDPBAM_BAM_P_FIFO_SIZES1_ADDR A:0x898820
y.create.l HWIO_QDSS_NDPBAM_BAM_P_DATA_FIFO_ADDR0_ADDR A:0x897824
y.create.l HWIO_QDSS_NDPBAM_BAM_P_DATA_FIFO_ADDR1_ADDR A:0x898824
y.create.l HWIO_QDSS_NDPBAM_BAM_P_EVNT_GEN_TRSHLD0_ADDR A:0x897828
y.create.l HWIO_QDSS_NDPBAM_BAM_P_EVNT_GEN_TRSHLD1_ADDR A:0x898828
y.create.l HWIO_QDSS_NDPBAM_BAM_P_EVNT_DEST_ADDR0_ADDR A:0x89782c
y.create.l HWIO_QDSS_NDPBAM_BAM_P_EVNT_DEST_ADDR1_ADDR A:0x89882c
y.create.l HWIO_QDSS_NDPBAM_BAM_P_DF_CNTXT_0_ADDR A:0x897830
y.create.l HWIO_QDSS_NDPBAM_BAM_P_DF_CNTXT_1_ADDR A:0x898830
y.create.l HWIO_QDSS_NDPBAM_BAM_P_RETR_CNTXT_0_ADDR A:0x897834
y.create.l HWIO_QDSS_NDPBAM_BAM_P_RETR_CNTXT_1_ADDR A:0x898834
y.create.l HWIO_QDSS_NDPBAM_BAM_P_SI_CNTXT_0_ADDR A:0x897838
y.create.l HWIO_QDSS_NDPBAM_BAM_P_SI_CNTXT_1_ADDR A:0x898838
y.create.l HWIO_QDSS_NDPBAM_BAM_P_PSM_CNTXT_3_LSB0_ADDR A:0x897900
y.create.l HWIO_QDSS_NDPBAM_BAM_P_PSM_CNTXT_3_LSB1_ADDR A:0x898900
y.create.l HWIO_QDSS_NDPBAM_BAM_P_PSM_CNTXT_3_MSB0_ADDR A:0x897904
y.create.l HWIO_QDSS_NDPBAM_BAM_P_PSM_CNTXT_3_MSB1_ADDR A:0x898904
y.create.l HWIO_QDSS_NDPBAM_BAM_P_DESC_FIFO_ADDR_LSB0_ADDR A:0x897910
y.create.l HWIO_QDSS_NDPBAM_BAM_P_DESC_FIFO_ADDR_LSB1_ADDR A:0x898910
y.create.l HWIO_QDSS_NDPBAM_BAM_P_DESC_FIFO_ADDR_MSB0_ADDR A:0x897914
y.create.l HWIO_QDSS_NDPBAM_BAM_P_DESC_FIFO_ADDR_MSB1_ADDR A:0x898914
y.create.l HWIO_QDSS_NDPBAM_BAM_P_DATA_FIFO_ADDR_LSB0_ADDR A:0x897920
y.create.l HWIO_QDSS_NDPBAM_BAM_P_DATA_FIFO_ADDR_LSB1_ADDR A:0x898920
y.create.l HWIO_QDSS_NDPBAM_BAM_P_DATA_FIFO_ADDR_MSB0_ADDR A:0x897924
y.create.l HWIO_QDSS_NDPBAM_BAM_P_DATA_FIFO_ADDR_MSB1_ADDR A:0x898924
y.create.l HWIO_QDSS_NDPBAM_BAM_P_EVNT_DEST_ADDR_LSB0_ADDR A:0x897930
y.create.l HWIO_QDSS_NDPBAM_BAM_P_EVNT_DEST_ADDR_LSB1_ADDR A:0x898930
y.create.l HWIO_QDSS_NDPBAM_BAM_P_EVNT_DEST_ADDR_MSB0_ADDR A:0x897934
y.create.l HWIO_QDSS_NDPBAM_BAM_P_EVNT_DEST_ADDR_MSB1_ADDR A:0x898934
y.create.l HWIO_QDSS_WRAPPER_ATB_FUN2X1_CTRL_REG_ADDR A:0x868000
y.create.l HWIO_QDSS_WRAPPER_ATB_FUN2X1_PRIORITY_CTRL_REG_ADDR A:0x868004
y.create.l HWIO_QDSS_WRAPPER_ATB_FUN2X1_ITATBDATA0_ADDR A:0x868eec
y.create.l HWIO_QDSS_WRAPPER_ATB_FUN2X1_ITATBCTR2_ADDR A:0x868ef0
y.create.l HWIO_QDSS_WRAPPER_ATB_FUN2X1_ITATBCTR1_ADDR A:0x868ef4
y.create.l HWIO_QDSS_WRAPPER_ATB_FUN2X1_ITATBCTR0_ADDR A:0x868ef8
y.create.l HWIO_QDSS_WRAPPER_ATB_FUN2X1_ITCTRL_ADDR A:0x868f00
y.create.l HWIO_QDSS_WRAPPER_ATB_FUN2X1_CLAIMSET_ADDR A:0x868fa0
y.create.l HWIO_QDSS_WRAPPER_ATB_FUN2X1_CLAIMCLR_ADDR A:0x868fa4
y.create.l HWIO_QDSS_WRAPPER_ATB_FUN2X1_LOCKACCESS_ADDR A:0x868fb0
y.create.l HWIO_QDSS_WRAPPER_ATB_FUN2X1_LOCKSTATUS_ADDR A:0x868fb4
y.create.l HWIO_QDSS_WRAPPER_ATB_FUN2X1_AUTHSTATUS_ADDR A:0x868fb8
y.create.l HWIO_QDSS_WRAPPER_ATB_FUN2X1_DEVID_ADDR A:0x868fc8
y.create.l HWIO_QDSS_WRAPPER_ATB_FUN2X1_DEVTYPE_ADDR A:0x868fcc
y.create.l HWIO_QDSS_WRAPPER_ATB_FUN2X1_PERIPHID0_ADDR A:0x868fe0
y.create.l HWIO_QDSS_WRAPPER_ATB_FUN2X1_PERIPHID1_ADDR A:0x868fe4
y.create.l HWIO_QDSS_WRAPPER_ATB_FUN2X1_PERIPHID2_ADDR A:0x868fe8
y.create.l HWIO_QDSS_WRAPPER_ATB_FUN2X1_PERIPHID3_ADDR A:0x868fec
y.create.l HWIO_QDSS_WRAPPER_ATB_FUN2X1_PERIPHID4_ADDR A:0x868fd0
y.create.l HWIO_QDSS_WRAPPER_ATB_FUN2X1_PERIPHID5_ADDR A:0x868fd4
y.create.l HWIO_QDSS_WRAPPER_ATB_FUN2X1_PERIPHID6_ADDR A:0x868fd8
y.create.l HWIO_QDSS_WRAPPER_ATB_FUN2X1_PERIPHID7_ADDR A:0x868fdc
y.create.l HWIO_QDSS_WRAPPER_ATB_FUN2X1_COMPID0_ADDR A:0x868ff0
y.create.l HWIO_QDSS_WRAPPER_ATB_FUN2X1_COMPID1_ADDR A:0x868ff4
y.create.l HWIO_QDSS_WRAPPER_ATB_FUN2X1_COMPID2_ADDR A:0x868ff8
y.create.l HWIO_QDSS_WRAPPER_ATB_FUN2X1_COMPID3_ADDR A:0x868ffc
y.create.l HWIO_QDSS_WRAPPER_ATB_FUN8X1_CTRL_REG_ADDR A:0x869000
y.create.l HWIO_QDSS_WRAPPER_ATB_FUN8X1_PRIORITY_CTRL_REG_ADDR A:0x869004
y.create.l HWIO_QDSS_WRAPPER_ATB_FUN8X1_ITATBDATA0_ADDR A:0x869eec
y.create.l HWIO_QDSS_WRAPPER_ATB_FUN8X1_ITATBCTR2_ADDR A:0x869ef0
y.create.l HWIO_QDSS_WRAPPER_ATB_FUN8X1_ITATBCTR1_ADDR A:0x869ef4
y.create.l HWIO_QDSS_WRAPPER_ATB_FUN8X1_ITATBCTR0_ADDR A:0x869ef8
y.create.l HWIO_QDSS_WRAPPER_ATB_FUN8X1_ITCTRL_ADDR A:0x869f00
y.create.l HWIO_QDSS_WRAPPER_ATB_FUN8X1_CLAIMSET_ADDR A:0x869fa0
y.create.l HWIO_QDSS_WRAPPER_ATB_FUN8X1_CLAIMCLR_ADDR A:0x869fa4
y.create.l HWIO_QDSS_WRAPPER_ATB_FUN8X1_LOCKACCESS_ADDR A:0x869fb0
y.create.l HWIO_QDSS_WRAPPER_ATB_FUN8X1_LOCKSTATUS_ADDR A:0x869fb4
y.create.l HWIO_QDSS_WRAPPER_ATB_FUN8X1_AUTHSTATUS_ADDR A:0x869fb8
y.create.l HWIO_QDSS_WRAPPER_ATB_FUN8X1_DEVID_ADDR A:0x869fc8
y.create.l HWIO_QDSS_WRAPPER_ATB_FUN8X1_DEVTYPE_ADDR A:0x869fcc
y.create.l HWIO_QDSS_WRAPPER_ATB_FUN8X1_PERIPHID0_ADDR A:0x869fe0
y.create.l HWIO_QDSS_WRAPPER_ATB_FUN8X1_PERIPHID1_ADDR A:0x869fe4
y.create.l HWIO_QDSS_WRAPPER_ATB_FUN8X1_PERIPHID2_ADDR A:0x869fe8
y.create.l HWIO_QDSS_WRAPPER_ATB_FUN8X1_PERIPHID3_ADDR A:0x869fec
y.create.l HWIO_QDSS_WRAPPER_ATB_FUN8X1_PERIPHID4_ADDR A:0x869fd0
y.create.l HWIO_QDSS_WRAPPER_ATB_FUN8X1_PERIPHID5_ADDR A:0x869fd4
y.create.l HWIO_QDSS_WRAPPER_ATB_FUN8X1_PERIPHID6_ADDR A:0x869fd8
y.create.l HWIO_QDSS_WRAPPER_ATB_FUN8X1_PERIPHID7_ADDR A:0x869fdc
y.create.l HWIO_QDSS_WRAPPER_ATB_FUN8X1_COMPID0_ADDR A:0x869ff0
y.create.l HWIO_QDSS_WRAPPER_ATB_FUN8X1_COMPID1_ADDR A:0x869ff4
y.create.l HWIO_QDSS_WRAPPER_ATB_FUN8X1_COMPID2_ADDR A:0x869ff8
y.create.l HWIO_QDSS_WRAPPER_ATB_FUN8X1_COMPID3_ADDR A:0x869ffc
y.create.l HWIO_QDSS_WRAPPER_HWEVENT_EXPD_COL0_OEN_REG_ADDR A:0x86c000
y.create.l HWIO_QDSS_WRAPPER_HWEVENT_EXPD_COL1_OEN_REG_ADDR A:0x86c004
y.create.l HWIO_QDSS_WRAPPER_HWEVENT_EXPD_COL2_OEN_REG_ADDR A:0x86c008
y.create.l HWIO_QDSS_WRAPPER_HWEVENT_EXPD_COL3_OEN_REG_ADDR A:0x86c00c
y.create.l HWIO_QDSS_WRAPPER_HWEVENT_EXPD_COL4_OEN_REG_ADDR A:0x86c010
y.create.l HWIO_QDSS_WRAPPER_HWEVENT_EXPD_COL5_OEN_REG_ADDR A:0x86c014
y.create.l HWIO_QDSS_WRAPPER_HWEVENT_EXPD_COL6_OEN_REG_ADDR A:0x86c018
y.create.l HWIO_QDSS_WRAPPER_HWEVENT_EXPD_COL7_OEN_REG_ADDR A:0x86c01c
y.create.l HWIO_QDSS_WRAPPER_HWEVENT_EXPD_COL8_OEN_REG_ADDR A:0x86c020
y.create.l HWIO_QDSS_WRAPPER_HWEVENT_EXPD_COL9_OEN_REG_ADDR A:0x86c024
y.create.l HWIO_QDSS_WRAPPER_HWEVENT_EXPD_COL0_MUX_SEL0_REG_ADDR A:0x86c040
y.create.l HWIO_QDSS_WRAPPER_HWEVENT_EXPD_COL1_MUX_SEL0_REG_ADDR A:0x86c050
y.create.l HWIO_QDSS_WRAPPER_HWEVENT_EXPD_COL2_MUX_SEL0_REG_ADDR A:0x86c060
y.create.l HWIO_QDSS_WRAPPER_HWEVENT_EXPD_COL3_MUX_SEL0_REG_ADDR A:0x86c070
y.create.l HWIO_QDSS_WRAPPER_HWEVENT_EXPD_COL4_MUX_SEL0_REG_ADDR A:0x86c080
y.create.l HWIO_QDSS_WRAPPER_HWEVENT_EXPD_COL5_MUX_SEL0_REG_ADDR A:0x86c090
y.create.l HWIO_QDSS_WRAPPER_HWEVENT_EXPD_COL6_MUX_SEL0_REG_ADDR A:0x86c0a0
y.create.l HWIO_QDSS_WRAPPER_HWEVENT_EXPD_COL7_MUX_SEL0_REG_ADDR A:0x86c0b0
y.create.l HWIO_QDSS_WRAPPER_HWEVENT_EXPD_COL8_MUX_SEL0_REG_ADDR A:0x86c0c0
y.create.l HWIO_QDSS_WRAPPER_HWEVENT_EXPD_COL9_MUX_SEL0_REG_ADDR A:0x86c0d0
y.create.l HWIO_QDSS_WRAPPER_HWEVENT_EXPD_COL0_MUX_SEL1_REG_ADDR A:0x86c044
y.create.l HWIO_QDSS_WRAPPER_HWEVENT_EXPD_COL1_MUX_SEL1_REG_ADDR A:0x86c054
y.create.l HWIO_QDSS_WRAPPER_HWEVENT_EXPD_COL2_MUX_SEL1_REG_ADDR A:0x86c064
y.create.l HWIO_QDSS_WRAPPER_HWEVENT_EXPD_COL3_MUX_SEL1_REG_ADDR A:0x86c074
y.create.l HWIO_QDSS_WRAPPER_HWEVENT_EXPD_COL4_MUX_SEL1_REG_ADDR A:0x86c084
y.create.l HWIO_QDSS_WRAPPER_HWEVENT_EXPD_COL5_MUX_SEL1_REG_ADDR A:0x86c094
y.create.l HWIO_QDSS_WRAPPER_HWEVENT_EXPD_COL6_MUX_SEL1_REG_ADDR A:0x86c0a4
y.create.l HWIO_QDSS_WRAPPER_HWEVENT_EXPD_COL7_MUX_SEL1_REG_ADDR A:0x86c0b4
y.create.l HWIO_QDSS_WRAPPER_HWEVENT_EXPD_COL8_MUX_SEL1_REG_ADDR A:0x86c0c4
y.create.l HWIO_QDSS_WRAPPER_HWEVENT_EXPD_COL9_MUX_SEL1_REG_ADDR A:0x86c0d4
y.create.l HWIO_QDSS_WRAPPER_HWEVENT_EXPD_COL0_MUX_SEL2_REG_ADDR A:0x86c048
y.create.l HWIO_QDSS_WRAPPER_HWEVENT_EXPD_COL1_MUX_SEL2_REG_ADDR A:0x86c058
y.create.l HWIO_QDSS_WRAPPER_HWEVENT_EXPD_COL2_MUX_SEL2_REG_ADDR A:0x86c068
y.create.l HWIO_QDSS_WRAPPER_HWEVENT_EXPD_COL3_MUX_SEL2_REG_ADDR A:0x86c078
y.create.l HWIO_QDSS_WRAPPER_HWEVENT_EXPD_COL4_MUX_SEL2_REG_ADDR A:0x86c088
y.create.l HWIO_QDSS_WRAPPER_HWEVENT_EXPD_COL5_MUX_SEL2_REG_ADDR A:0x86c098
y.create.l HWIO_QDSS_WRAPPER_HWEVENT_EXPD_COL6_MUX_SEL2_REG_ADDR A:0x86c0a8
y.create.l HWIO_QDSS_WRAPPER_HWEVENT_EXPD_COL7_MUX_SEL2_REG_ADDR A:0x86c0b8
y.create.l HWIO_QDSS_WRAPPER_HWEVENT_EXPD_COL8_MUX_SEL2_REG_ADDR A:0x86c0c8
y.create.l HWIO_QDSS_WRAPPER_HWEVENT_EXPD_COL9_MUX_SEL2_REG_ADDR A:0x86c0d8
y.create.l HWIO_QDSS_WRAPPER_HWEVENT_EXPD_COL0_MUX_SEL3_REG_ADDR A:0x86c04c
y.create.l HWIO_QDSS_WRAPPER_HWEVENT_EXPD_COL1_MUX_SEL3_REG_ADDR A:0x86c05c
y.create.l HWIO_QDSS_WRAPPER_HWEVENT_EXPD_COL2_MUX_SEL3_REG_ADDR A:0x86c06c
y.create.l HWIO_QDSS_WRAPPER_HWEVENT_EXPD_COL3_MUX_SEL3_REG_ADDR A:0x86c07c
y.create.l HWIO_QDSS_WRAPPER_HWEVENT_EXPD_COL4_MUX_SEL3_REG_ADDR A:0x86c08c
y.create.l HWIO_QDSS_WRAPPER_HWEVENT_EXPD_COL5_MUX_SEL3_REG_ADDR A:0x86c09c
y.create.l HWIO_QDSS_WRAPPER_HWEVENT_EXPD_COL6_MUX_SEL3_REG_ADDR A:0x86c0ac
y.create.l HWIO_QDSS_WRAPPER_HWEVENT_EXPD_COL7_MUX_SEL3_REG_ADDR A:0x86c0bc
y.create.l HWIO_QDSS_WRAPPER_HWEVENT_EXPD_COL8_MUX_SEL3_REG_ADDR A:0x86c0cc
y.create.l HWIO_QDSS_WRAPPER_HWEVENT_EXPD_COL9_MUX_SEL3_REG_ADDR A:0x86c0dc
y.create.l HWIO_QDSS_WRAPPER_IRQ_MUX_REG_ADDR A:0x86c140
y.create.l HWIO_QDSS_WRAPPER_HWE_SPDM_MUX_REG_ADDR A:0x86c144
y.create.l HWIO_QDSS_WRAPPER_CS_HWE_EXPD_ITCTL_ADDR A:0x86cf00
y.create.l HWIO_QDSS_WRAPPER_CS_HWE_EXPD_CLAIMSET_ADDR A:0x86cfa0
y.create.l HWIO_QDSS_WRAPPER_CS_HWE_EXPD_CLAIMCLR_ADDR A:0x86cfa4
y.create.l HWIO_QDSS_WRAPPER_CS_HWE_EXPD_LOCKACCESS_ADDR A:0x86cfb0
y.create.l HWIO_QDSS_WRAPPER_CS_HWE_EXPD_LOCKSTATUS_ADDR A:0x86cfb4
y.create.l HWIO_QDSS_WRAPPER_CS_HWE_EXPD_AUTHSTATUS_ADDR A:0x86cfb8
y.create.l HWIO_QDSS_WRAPPER_CS_HWE_EXPD_DEVICEID_ADDR A:0x86cfc8
y.create.l HWIO_QDSS_WRAPPER_CS_HWE_EXPD_DEVICETYPE_ADDR A:0x86cfcc
y.create.l HWIO_QDSS_WRAPPER_CS_HWE_EXPD_PERIPHID4_ADDR A:0x86cfd0
y.create.l HWIO_QDSS_WRAPPER_CS_HWE_EXPD_PERIPHID5_ADDR A:0x86cfd4
y.create.l HWIO_QDSS_WRAPPER_CS_HWE_EXPD_PERIPHID6_ADDR A:0x86cfd8
y.create.l HWIO_QDSS_WRAPPER_CS_HWE_EXPD_PERIPHID7_ADDR A:0x86cfdc
y.create.l HWIO_QDSS_WRAPPER_CS_HWE_EXPD_PERIPHID0_ADDR A:0x86cfe0
y.create.l HWIO_QDSS_WRAPPER_CS_HWE_EXPD_PERIPHID1_ADDR A:0x86cfe4
y.create.l HWIO_QDSS_WRAPPER_CS_HWE_EXPD_PERIPHID2_ADDR A:0x86cfe8
y.create.l HWIO_QDSS_WRAPPER_CS_HWE_EXPD_PERIPHID3_ADDR A:0x86cfec
y.create.l HWIO_QDSS_WRAPPER_CS_HWE_EXPD_COMPID0_ADDR A:0x86cff0
y.create.l HWIO_QDSS_WRAPPER_CS_HWE_EXPD_COMPID1_ADDR A:0x86cff4
y.create.l HWIO_QDSS_WRAPPER_CS_HWE_EXPD_COMPID2_ADDR A:0x86cff8
y.create.l HWIO_QDSS_WRAPPER_CS_HWE_EXPD_COMPID3_ADDR A:0x86cffc
y.create.l HWIO_QDSS_WRAPPER_DEBUG_UI_SECURE_ADDR A:0x86d000
y.create.l HWIO_QDSS_WRAPPER_DEBUG_UI_CTL_ADDR A:0x86d004
y.create.l HWIO_QDSS_WRAPPER_DEBUG_UI_CTL_MASK_ADDR A:0x86d008
y.create.l HWIO_QDSS_WRAPPER_DEBUG_UI_SWTRIG_ADDR A:0x86d00c
y.create.l HWIO_QDSS_WRAPPER_DEBUG_UI_STATUS_ADDR A:0x86d010
y.create.l HWIO_QDSS_WRAPPER_DEBUG_UI_HWE_MASK_ADDR A:0x86d014
y.create.l HWIO_QDSS_WRAPPER_DEBUG_UI_CTR_VAL_ADDR A:0x86d018
y.create.l HWIO_QDSS_WRAPPER_DEBUG_UI_CTR_EN_ADDR A:0x86d01c
y.create.l HWIO_QDSS_WRAPPER_DEBUG_UI_NUM_REGS_RD_ADDR A:0x86d020
y.create.l HWIO_QDSS_WRAPPER_DEBUG_UI_ATB_REG_ADDR A:0x86d024
y.create.l HWIO_QDSS_WRAPPER_DEBUG_UI_ADDR_0_ADDR A:0x86d030
y.create.l HWIO_QDSS_WRAPPER_DEBUG_UI_ADDR_1_ADDR A:0x86d034
y.create.l HWIO_QDSS_WRAPPER_DEBUG_UI_ADDR_2_ADDR A:0x86d038
y.create.l HWIO_QDSS_WRAPPER_DEBUG_UI_ADDR_3_ADDR A:0x86d03c
y.create.l HWIO_QDSS_WRAPPER_DEBUG_UI_ADDR_4_ADDR A:0x86d040
y.create.l HWIO_QDSS_WRAPPER_DEBUG_UI_ADDR_5_ADDR A:0x86d044
y.create.l HWIO_QDSS_WRAPPER_DEBUG_UI_ADDR_6_ADDR A:0x86d048
y.create.l HWIO_QDSS_WRAPPER_DEBUG_UI_ADDR_7_ADDR A:0x86d04c
y.create.l HWIO_QDSS_WRAPPER_DEBUG_UI_ADDR_8_ADDR A:0x86d050
y.create.l HWIO_QDSS_WRAPPER_DEBUG_UI_ADDR_9_ADDR A:0x86d054
y.create.l HWIO_QDSS_WRAPPER_DEBUG_UI_ADDR_10_ADDR A:0x86d058
y.create.l HWIO_QDSS_WRAPPER_DEBUG_UI_ADDR_11_ADDR A:0x86d05c
y.create.l HWIO_QDSS_WRAPPER_DEBUG_UI_ADDR_12_ADDR A:0x86d060
y.create.l HWIO_QDSS_WRAPPER_DEBUG_UI_ADDR_13_ADDR A:0x86d064
y.create.l HWIO_QDSS_WRAPPER_DEBUG_UI_ADDR_14_ADDR A:0x86d068
y.create.l HWIO_QDSS_WRAPPER_DEBUG_UI_ADDR_15_ADDR A:0x86d06c
y.create.l HWIO_QDSS_WRAPPER_DEBUG_UI_ADDR_16_ADDR A:0x86d070
y.create.l HWIO_QDSS_WRAPPER_DEBUG_UI_ADDR_17_ADDR A:0x86d074
y.create.l HWIO_QDSS_WRAPPER_DEBUG_UI_ADDR_18_ADDR A:0x86d078
y.create.l HWIO_QDSS_WRAPPER_DEBUG_UI_ADDR_19_ADDR A:0x86d07c
y.create.l HWIO_QDSS_WRAPPER_DEBUG_UI_ADDR_20_ADDR A:0x86d080
y.create.l HWIO_QDSS_WRAPPER_DEBUG_UI_ADDR_21_ADDR A:0x86d084
y.create.l HWIO_QDSS_WRAPPER_DEBUG_UI_DATA_0_ADDR A:0x86d0b0
y.create.l HWIO_QDSS_WRAPPER_DEBUG_UI_DATA_1_ADDR A:0x86d0b4
y.create.l HWIO_QDSS_WRAPPER_DEBUG_UI_DATA_2_ADDR A:0x86d0b8
y.create.l HWIO_QDSS_WRAPPER_DEBUG_UI_DATA_3_ADDR A:0x86d0bc
y.create.l HWIO_QDSS_WRAPPER_DEBUG_UI_DATA_4_ADDR A:0x86d0c0
y.create.l HWIO_QDSS_WRAPPER_DEBUG_UI_DATA_5_ADDR A:0x86d0c4
y.create.l HWIO_QDSS_WRAPPER_DEBUG_UI_DATA_6_ADDR A:0x86d0c8
y.create.l HWIO_QDSS_WRAPPER_DEBUG_UI_DATA_7_ADDR A:0x86d0cc
y.create.l HWIO_QDSS_WRAPPER_DEBUG_UI_DATA_8_ADDR A:0x86d0d0
y.create.l HWIO_QDSS_WRAPPER_DEBUG_UI_DATA_9_ADDR A:0x86d0d4
y.create.l HWIO_QDSS_WRAPPER_CS_DEBUG_UI_ITCTL_ADDR A:0x86df00
y.create.l HWIO_QDSS_WRAPPER_CS_DEBUG_UI_CLAIMSET_ADDR A:0x86dfa0
y.create.l HWIO_QDSS_WRAPPER_CS_DEBUG_UI_CLAIMCLR_ADDR A:0x86dfa4
y.create.l HWIO_QDSS_WRAPPER_CS_DEBUG_UI_LOCKACCESS_ADDR A:0x86dfb0
y.create.l HWIO_QDSS_WRAPPER_CS_DEBUG_UI_LOCKSTATUS_ADDR A:0x86dfb4
y.create.l HWIO_QDSS_WRAPPER_CS_DEBUG_UI_AUTHSTATUS_ADDR A:0x86dfb8
y.create.l HWIO_QDSS_WRAPPER_CS_DEBUG_UI_DEVICEID_ADDR A:0x86dfc8
y.create.l HWIO_QDSS_WRAPPER_CS_DEBUG_UI_DEVICETYPE_ADDR A:0x86dfcc
y.create.l HWIO_QDSS_WRAPPER_CS_DEBUG_UI_PERIPHID4_ADDR A:0x86dfd0
y.create.l HWIO_QDSS_WRAPPER_CS_DEBUG_UI_PERIPHID5_ADDR A:0x86dfd4
y.create.l HWIO_QDSS_WRAPPER_CS_DEBUG_UI_PERIPHID6_ADDR A:0x86dfd8
y.create.l HWIO_QDSS_WRAPPER_CS_DEBUG_UI_PERIPHID7_ADDR A:0x86dfdc
y.create.l HWIO_QDSS_WRAPPER_CS_DEBUG_UI_PERIPHID0_ADDR A:0x86dfe0
y.create.l HWIO_QDSS_WRAPPER_CS_DEBUG_UI_PERIPHID1_ADDR A:0x86dfe4
y.create.l HWIO_QDSS_WRAPPER_CS_DEBUG_UI_PERIPHID2_ADDR A:0x86dfe8
y.create.l HWIO_QDSS_WRAPPER_CS_DEBUG_UI_PERIPHID3_ADDR A:0x86dfec
y.create.l HWIO_QDSS_WRAPPER_CS_DEBUG_UI_COMPID0_ADDR A:0x86dff0
y.create.l HWIO_QDSS_WRAPPER_CS_DEBUG_UI_COMPID1_ADDR A:0x86dff4
y.create.l HWIO_QDSS_WRAPPER_CS_DEBUG_UI_COMPID2_ADDR A:0x86dff8
y.create.l HWIO_QDSS_WRAPPER_CS_DEBUG_UI_COMPID3_ADDR A:0x86dffc
y.create.l HWIO_QPIC_QPIC_BAM_CTRL_ADDR A:0x7984000
y.create.l HWIO_QPIC_QPIC_BAM_TIMER_ADDR A:0x7984040
y.create.l HWIO_QPIC_QPIC_BAM_TIMER_CTRL_ADDR A:0x7984044
y.create.l HWIO_QPIC_QPIC_BAM_DESC_CNT_TRSHLD_ADDR A:0x7984008
y.create.l HWIO_QPIC_QPIC_BAM_IRQ_STTS_ADDR A:0x7984014
y.create.l HWIO_QPIC_QPIC_BAM_IRQ_CLR_ADDR A:0x7984018
y.create.l HWIO_QPIC_QPIC_BAM_IRQ_EN_ADDR A:0x798401c
y.create.l HWIO_QPIC_QPIC_BAM_CNFG_BITS_ADDR A:0x798407c
y.create.l HWIO_QPIC_QPIC_BAM_REVISION_ADDR A:0x7985000
y.create.l HWIO_QPIC_QPIC_BAM_SW_VERSION_ADDR A:0x7985004
y.create.l HWIO_QPIC_QPIC_BAM_NUM_PIPES_ADDR A:0x7985008
y.create.l HWIO_QPIC_QPIC_BAM_TEST_BUS_SEL_ADDR A:0x7985010
y.create.l HWIO_QPIC_QPIC_BAM_TEST_BUS_REG_ADDR A:0x7985014
y.create.l HWIO_QPIC_QPIC_BAM_AHB_MASTER_ERR_CTRLS_ADDR A:0x7985024
y.create.l HWIO_QPIC_QPIC_BAM_AHB_MASTER_ERR_ADDR_ADDR A:0x7985028
y.create.l HWIO_QPIC_QPIC_BAM_AHB_MASTER_ERR_DATA_ADDR A:0x798502c
y.create.l HWIO_QPIC_QPIC_BAM_AHB_MASTER_ERR_ADDR_LSB_ADDR A:0x7985100
y.create.l HWIO_QPIC_QPIC_BAM_AHB_MASTER_ERR_ADDR_MSB_ADDR A:0x7985104
y.create.l HWIO_QPIC_QPIC_BAM_TRUST_REG_ADDR A:0x7986000
y.create.l HWIO_QPIC_QPIC_BAM_P_TRUST_REG0_ADDR A:0x7986020
y.create.l HWIO_QPIC_QPIC_BAM_P_TRUST_REG1_ADDR A:0x7986024
y.create.l HWIO_QPIC_QPIC_BAM_P_TRUST_REG2_ADDR A:0x7986028
y.create.l HWIO_QPIC_QPIC_BAM_P_TRUST_REG3_ADDR A:0x798602c
y.create.l HWIO_QPIC_QPIC_BAM_P_TRUST_REG4_ADDR A:0x7986030
y.create.l HWIO_QPIC_QPIC_BAM_P_TRUST_REG5_ADDR A:0x7986034
y.create.l HWIO_QPIC_QPIC_BAM_P_TRUST_REG6_ADDR A:0x7986038
y.create.l HWIO_QPIC_QPIC_BAM_IRQ_SRCS_EE0_ADDR A:0x7987000
y.create.l HWIO_QPIC_QPIC_BAM_IRQ_SRCS_EE1_ADDR A:0x7988000
y.create.l HWIO_QPIC_QPIC_BAM_IRQ_SRCS_EE2_ADDR A:0x7989000
y.create.l HWIO_QPIC_QPIC_BAM_IRQ_SRCS_EE3_ADDR A:0x798a000
y.create.l HWIO_QPIC_QPIC_BAM_IRQ_SRCS_EE4_ADDR A:0x798b000
y.create.l HWIO_QPIC_QPIC_BAM_IRQ_SRCS_EE5_ADDR A:0x798c000
y.create.l HWIO_QPIC_QPIC_BAM_IRQ_SRCS_EE6_ADDR A:0x798d000
y.create.l HWIO_QPIC_QPIC_BAM_IRQ_SRCS_EE7_ADDR A:0x798e000
y.create.l HWIO_QPIC_QPIC_BAM_IRQ_SRCS_MSK_EE0_ADDR A:0x7987004
y.create.l HWIO_QPIC_QPIC_BAM_IRQ_SRCS_MSK_EE1_ADDR A:0x7988004
y.create.l HWIO_QPIC_QPIC_BAM_IRQ_SRCS_MSK_EE2_ADDR A:0x7989004
y.create.l HWIO_QPIC_QPIC_BAM_IRQ_SRCS_MSK_EE3_ADDR A:0x798a004
y.create.l HWIO_QPIC_QPIC_BAM_IRQ_SRCS_MSK_EE4_ADDR A:0x798b004
y.create.l HWIO_QPIC_QPIC_BAM_IRQ_SRCS_MSK_EE5_ADDR A:0x798c004
y.create.l HWIO_QPIC_QPIC_BAM_IRQ_SRCS_MSK_EE6_ADDR A:0x798d004
y.create.l HWIO_QPIC_QPIC_BAM_IRQ_SRCS_MSK_EE7_ADDR A:0x798e004
y.create.l HWIO_QPIC_QPIC_BAM_IRQ_SRCS_UNMASKED_EE0_ADDR A:0x7987008
y.create.l HWIO_QPIC_QPIC_BAM_IRQ_SRCS_UNMASKED_EE1_ADDR A:0x7988008
y.create.l HWIO_QPIC_QPIC_BAM_IRQ_SRCS_UNMASKED_EE2_ADDR A:0x7989008
y.create.l HWIO_QPIC_QPIC_BAM_IRQ_SRCS_UNMASKED_EE3_ADDR A:0x798a008
y.create.l HWIO_QPIC_QPIC_BAM_IRQ_SRCS_UNMASKED_EE4_ADDR A:0x798b008
y.create.l HWIO_QPIC_QPIC_BAM_IRQ_SRCS_UNMASKED_EE5_ADDR A:0x798c008
y.create.l HWIO_QPIC_QPIC_BAM_IRQ_SRCS_UNMASKED_EE6_ADDR A:0x798d008
y.create.l HWIO_QPIC_QPIC_BAM_IRQ_SRCS_UNMASKED_EE7_ADDR A:0x798e008
y.create.l HWIO_QPIC_QPIC_BAM_PIPE_ATTR_EE0_ADDR A:0x798700c
y.create.l HWIO_QPIC_QPIC_BAM_PIPE_ATTR_EE1_ADDR A:0x798800c
y.create.l HWIO_QPIC_QPIC_BAM_PIPE_ATTR_EE2_ADDR A:0x798900c
y.create.l HWIO_QPIC_QPIC_BAM_PIPE_ATTR_EE3_ADDR A:0x798a00c
y.create.l HWIO_QPIC_QPIC_BAM_PIPE_ATTR_EE4_ADDR A:0x798b00c
y.create.l HWIO_QPIC_QPIC_BAM_PIPE_ATTR_EE5_ADDR A:0x798c00c
y.create.l HWIO_QPIC_QPIC_BAM_PIPE_ATTR_EE6_ADDR A:0x798d00c
y.create.l HWIO_QPIC_QPIC_BAM_PIPE_ATTR_EE7_ADDR A:0x798e00c
y.create.l HWIO_QPIC_QPIC_BAM_IRQ_SRCS_ADDR A:0x7987010
y.create.l HWIO_QPIC_QPIC_BAM_IRQ_SRCS_MSK_ADDR A:0x7987014
y.create.l HWIO_QPIC_QPIC_BAM_IRQ_SRCS_UNMASKED_ADDR A:0x7987018
y.create.l HWIO_QPIC_QPIC_BAM_P_CTRL0_ADDR A:0x7997000
y.create.l HWIO_QPIC_QPIC_BAM_P_CTRL1_ADDR A:0x7998000
y.create.l HWIO_QPIC_QPIC_BAM_P_CTRL2_ADDR A:0x7999000
y.create.l HWIO_QPIC_QPIC_BAM_P_CTRL3_ADDR A:0x799a000
y.create.l HWIO_QPIC_QPIC_BAM_P_CTRL4_ADDR A:0x799b000
y.create.l HWIO_QPIC_QPIC_BAM_P_CTRL5_ADDR A:0x799c000
y.create.l HWIO_QPIC_QPIC_BAM_P_CTRL6_ADDR A:0x799d000
y.create.l HWIO_QPIC_QPIC_BAM_P_RST0_ADDR A:0x7997004
y.create.l HWIO_QPIC_QPIC_BAM_P_RST1_ADDR A:0x7998004
y.create.l HWIO_QPIC_QPIC_BAM_P_RST2_ADDR A:0x7999004
y.create.l HWIO_QPIC_QPIC_BAM_P_RST3_ADDR A:0x799a004
y.create.l HWIO_QPIC_QPIC_BAM_P_RST4_ADDR A:0x799b004
y.create.l HWIO_QPIC_QPIC_BAM_P_RST5_ADDR A:0x799c004
y.create.l HWIO_QPIC_QPIC_BAM_P_RST6_ADDR A:0x799d004
y.create.l HWIO_QPIC_QPIC_BAM_P_HALT0_ADDR A:0x7997008
y.create.l HWIO_QPIC_QPIC_BAM_P_HALT1_ADDR A:0x7998008
y.create.l HWIO_QPIC_QPIC_BAM_P_HALT2_ADDR A:0x7999008
y.create.l HWIO_QPIC_QPIC_BAM_P_HALT3_ADDR A:0x799a008
y.create.l HWIO_QPIC_QPIC_BAM_P_HALT4_ADDR A:0x799b008
y.create.l HWIO_QPIC_QPIC_BAM_P_HALT5_ADDR A:0x799c008
y.create.l HWIO_QPIC_QPIC_BAM_P_HALT6_ADDR A:0x799d008
y.create.l HWIO_QPIC_QPIC_BAM_P_IRQ_STTS0_ADDR A:0x7997010
y.create.l HWIO_QPIC_QPIC_BAM_P_IRQ_STTS1_ADDR A:0x7998010
y.create.l HWIO_QPIC_QPIC_BAM_P_IRQ_STTS2_ADDR A:0x7999010
y.create.l HWIO_QPIC_QPIC_BAM_P_IRQ_STTS3_ADDR A:0x799a010
y.create.l HWIO_QPIC_QPIC_BAM_P_IRQ_STTS4_ADDR A:0x799b010
y.create.l HWIO_QPIC_QPIC_BAM_P_IRQ_STTS5_ADDR A:0x799c010
y.create.l HWIO_QPIC_QPIC_BAM_P_IRQ_STTS6_ADDR A:0x799d010
y.create.l HWIO_QPIC_QPIC_BAM_P_IRQ_CLR0_ADDR A:0x7997014
y.create.l HWIO_QPIC_QPIC_BAM_P_IRQ_CLR1_ADDR A:0x7998014
y.create.l HWIO_QPIC_QPIC_BAM_P_IRQ_CLR2_ADDR A:0x7999014
y.create.l HWIO_QPIC_QPIC_BAM_P_IRQ_CLR3_ADDR A:0x799a014
y.create.l HWIO_QPIC_QPIC_BAM_P_IRQ_CLR4_ADDR A:0x799b014
y.create.l HWIO_QPIC_QPIC_BAM_P_IRQ_CLR5_ADDR A:0x799c014
y.create.l HWIO_QPIC_QPIC_BAM_P_IRQ_CLR6_ADDR A:0x799d014
y.create.l HWIO_QPIC_QPIC_BAM_P_IRQ_EN0_ADDR A:0x7997018
y.create.l HWIO_QPIC_QPIC_BAM_P_IRQ_EN1_ADDR A:0x7998018
y.create.l HWIO_QPIC_QPIC_BAM_P_IRQ_EN2_ADDR A:0x7999018
y.create.l HWIO_QPIC_QPIC_BAM_P_IRQ_EN3_ADDR A:0x799a018
y.create.l HWIO_QPIC_QPIC_BAM_P_IRQ_EN4_ADDR A:0x799b018
y.create.l HWIO_QPIC_QPIC_BAM_P_IRQ_EN5_ADDR A:0x799c018
y.create.l HWIO_QPIC_QPIC_BAM_P_IRQ_EN6_ADDR A:0x799d018
y.create.l HWIO_QPIC_QPIC_BAM_P_TIMER0_ADDR A:0x799701c
y.create.l HWIO_QPIC_QPIC_BAM_P_TIMER1_ADDR A:0x799801c
y.create.l HWIO_QPIC_QPIC_BAM_P_TIMER2_ADDR A:0x799901c
y.create.l HWIO_QPIC_QPIC_BAM_P_TIMER3_ADDR A:0x799a01c
y.create.l HWIO_QPIC_QPIC_BAM_P_TIMER4_ADDR A:0x799b01c
y.create.l HWIO_QPIC_QPIC_BAM_P_TIMER5_ADDR A:0x799c01c
y.create.l HWIO_QPIC_QPIC_BAM_P_TIMER6_ADDR A:0x799d01c
y.create.l HWIO_QPIC_QPIC_BAM_P_TIMER_CTRL0_ADDR A:0x7997020
y.create.l HWIO_QPIC_QPIC_BAM_P_TIMER_CTRL1_ADDR A:0x7998020
y.create.l HWIO_QPIC_QPIC_BAM_P_TIMER_CTRL2_ADDR A:0x7999020
y.create.l HWIO_QPIC_QPIC_BAM_P_TIMER_CTRL3_ADDR A:0x799a020
y.create.l HWIO_QPIC_QPIC_BAM_P_TIMER_CTRL4_ADDR A:0x799b020
y.create.l HWIO_QPIC_QPIC_BAM_P_TIMER_CTRL5_ADDR A:0x799c020
y.create.l HWIO_QPIC_QPIC_BAM_P_TIMER_CTRL6_ADDR A:0x799d020
y.create.l HWIO_QPIC_QPIC_BAM_P_PRDCR_SDBND0_ADDR A:0x7997024
y.create.l HWIO_QPIC_QPIC_BAM_P_PRDCR_SDBND1_ADDR A:0x7998024
y.create.l HWIO_QPIC_QPIC_BAM_P_PRDCR_SDBND2_ADDR A:0x7999024
y.create.l HWIO_QPIC_QPIC_BAM_P_PRDCR_SDBND3_ADDR A:0x799a024
y.create.l HWIO_QPIC_QPIC_BAM_P_PRDCR_SDBND4_ADDR A:0x799b024
y.create.l HWIO_QPIC_QPIC_BAM_P_PRDCR_SDBND5_ADDR A:0x799c024
y.create.l HWIO_QPIC_QPIC_BAM_P_PRDCR_SDBND6_ADDR A:0x799d024
y.create.l HWIO_QPIC_QPIC_BAM_P_CNSMR_SDBND0_ADDR A:0x7997028
y.create.l HWIO_QPIC_QPIC_BAM_P_CNSMR_SDBND1_ADDR A:0x7998028
y.create.l HWIO_QPIC_QPIC_BAM_P_CNSMR_SDBND2_ADDR A:0x7999028
y.create.l HWIO_QPIC_QPIC_BAM_P_CNSMR_SDBND3_ADDR A:0x799a028
y.create.l HWIO_QPIC_QPIC_BAM_P_CNSMR_SDBND4_ADDR A:0x799b028
y.create.l HWIO_QPIC_QPIC_BAM_P_CNSMR_SDBND5_ADDR A:0x799c028
y.create.l HWIO_QPIC_QPIC_BAM_P_CNSMR_SDBND6_ADDR A:0x799d028
y.create.l HWIO_QPIC_QPIC_BAM_P_SW_OFSTS0_ADDR A:0x7997800
y.create.l HWIO_QPIC_QPIC_BAM_P_SW_OFSTS1_ADDR A:0x7998800
y.create.l HWIO_QPIC_QPIC_BAM_P_SW_OFSTS2_ADDR A:0x7999800
y.create.l HWIO_QPIC_QPIC_BAM_P_SW_OFSTS3_ADDR A:0x799a800
y.create.l HWIO_QPIC_QPIC_BAM_P_SW_OFSTS4_ADDR A:0x799b800
y.create.l HWIO_QPIC_QPIC_BAM_P_SW_OFSTS5_ADDR A:0x799c800
y.create.l HWIO_QPIC_QPIC_BAM_P_SW_OFSTS6_ADDR A:0x799d800
y.create.l HWIO_QPIC_QPIC_BAM_P_AU_PSM_CNTXT_1_0_ADDR A:0x7997804
y.create.l HWIO_QPIC_QPIC_BAM_P_AU_PSM_CNTXT_1_1_ADDR A:0x7998804
y.create.l HWIO_QPIC_QPIC_BAM_P_AU_PSM_CNTXT_1_2_ADDR A:0x7999804
y.create.l HWIO_QPIC_QPIC_BAM_P_AU_PSM_CNTXT_1_3_ADDR A:0x799a804
y.create.l HWIO_QPIC_QPIC_BAM_P_AU_PSM_CNTXT_1_4_ADDR A:0x799b804
y.create.l HWIO_QPIC_QPIC_BAM_P_AU_PSM_CNTXT_1_5_ADDR A:0x799c804
y.create.l HWIO_QPIC_QPIC_BAM_P_AU_PSM_CNTXT_1_6_ADDR A:0x799d804
y.create.l HWIO_QPIC_QPIC_BAM_P_PSM_CNTXT_2_0_ADDR A:0x7997808
y.create.l HWIO_QPIC_QPIC_BAM_P_PSM_CNTXT_2_1_ADDR A:0x7998808
y.create.l HWIO_QPIC_QPIC_BAM_P_PSM_CNTXT_2_2_ADDR A:0x7999808
y.create.l HWIO_QPIC_QPIC_BAM_P_PSM_CNTXT_2_3_ADDR A:0x799a808
y.create.l HWIO_QPIC_QPIC_BAM_P_PSM_CNTXT_2_4_ADDR A:0x799b808
y.create.l HWIO_QPIC_QPIC_BAM_P_PSM_CNTXT_2_5_ADDR A:0x799c808
y.create.l HWIO_QPIC_QPIC_BAM_P_PSM_CNTXT_2_6_ADDR A:0x799d808
y.create.l HWIO_QPIC_QPIC_BAM_P_PSM_CNTXT_3_0_ADDR A:0x799780c
y.create.l HWIO_QPIC_QPIC_BAM_P_PSM_CNTXT_3_1_ADDR A:0x799880c
y.create.l HWIO_QPIC_QPIC_BAM_P_PSM_CNTXT_3_2_ADDR A:0x799980c
y.create.l HWIO_QPIC_QPIC_BAM_P_PSM_CNTXT_3_3_ADDR A:0x799a80c
y.create.l HWIO_QPIC_QPIC_BAM_P_PSM_CNTXT_3_4_ADDR A:0x799b80c
y.create.l HWIO_QPIC_QPIC_BAM_P_PSM_CNTXT_3_5_ADDR A:0x799c80c
y.create.l HWIO_QPIC_QPIC_BAM_P_PSM_CNTXT_3_6_ADDR A:0x799d80c
y.create.l HWIO_QPIC_QPIC_BAM_P_PSM_CNTXT_4_0_ADDR A:0x7997810
y.create.l HWIO_QPIC_QPIC_BAM_P_PSM_CNTXT_4_1_ADDR A:0x7998810
y.create.l HWIO_QPIC_QPIC_BAM_P_PSM_CNTXT_4_2_ADDR A:0x7999810
y.create.l HWIO_QPIC_QPIC_BAM_P_PSM_CNTXT_4_3_ADDR A:0x799a810
y.create.l HWIO_QPIC_QPIC_BAM_P_PSM_CNTXT_4_4_ADDR A:0x799b810
y.create.l HWIO_QPIC_QPIC_BAM_P_PSM_CNTXT_4_5_ADDR A:0x799c810
y.create.l HWIO_QPIC_QPIC_BAM_P_PSM_CNTXT_4_6_ADDR A:0x799d810
y.create.l HWIO_QPIC_QPIC_BAM_P_PSM_CNTXT_5_0_ADDR A:0x7997814
y.create.l HWIO_QPIC_QPIC_BAM_P_PSM_CNTXT_5_1_ADDR A:0x7998814
y.create.l HWIO_QPIC_QPIC_BAM_P_PSM_CNTXT_5_2_ADDR A:0x7999814
y.create.l HWIO_QPIC_QPIC_BAM_P_PSM_CNTXT_5_3_ADDR A:0x799a814
y.create.l HWIO_QPIC_QPIC_BAM_P_PSM_CNTXT_5_4_ADDR A:0x799b814
y.create.l HWIO_QPIC_QPIC_BAM_P_PSM_CNTXT_5_5_ADDR A:0x799c814
y.create.l HWIO_QPIC_QPIC_BAM_P_PSM_CNTXT_5_6_ADDR A:0x799d814
y.create.l HWIO_QPIC_QPIC_BAM_P_EVNT_REG0_ADDR A:0x7997818
y.create.l HWIO_QPIC_QPIC_BAM_P_EVNT_REG1_ADDR A:0x7998818
y.create.l HWIO_QPIC_QPIC_BAM_P_EVNT_REG2_ADDR A:0x7999818
y.create.l HWIO_QPIC_QPIC_BAM_P_EVNT_REG3_ADDR A:0x799a818
y.create.l HWIO_QPIC_QPIC_BAM_P_EVNT_REG4_ADDR A:0x799b818
y.create.l HWIO_QPIC_QPIC_BAM_P_EVNT_REG5_ADDR A:0x799c818
y.create.l HWIO_QPIC_QPIC_BAM_P_EVNT_REG6_ADDR A:0x799d818
y.create.l HWIO_QPIC_QPIC_BAM_P_DESC_FIFO_ADDR0_ADDR A:0x799781c
y.create.l HWIO_QPIC_QPIC_BAM_P_DESC_FIFO_ADDR1_ADDR A:0x799881c
y.create.l HWIO_QPIC_QPIC_BAM_P_DESC_FIFO_ADDR2_ADDR A:0x799981c
y.create.l HWIO_QPIC_QPIC_BAM_P_DESC_FIFO_ADDR3_ADDR A:0x799a81c
y.create.l HWIO_QPIC_QPIC_BAM_P_DESC_FIFO_ADDR4_ADDR A:0x799b81c
y.create.l HWIO_QPIC_QPIC_BAM_P_DESC_FIFO_ADDR5_ADDR A:0x799c81c
y.create.l HWIO_QPIC_QPIC_BAM_P_DESC_FIFO_ADDR6_ADDR A:0x799d81c
y.create.l HWIO_QPIC_QPIC_BAM_P_FIFO_SIZES0_ADDR A:0x7997820
y.create.l HWIO_QPIC_QPIC_BAM_P_FIFO_SIZES1_ADDR A:0x7998820
y.create.l HWIO_QPIC_QPIC_BAM_P_FIFO_SIZES2_ADDR A:0x7999820
y.create.l HWIO_QPIC_QPIC_BAM_P_FIFO_SIZES3_ADDR A:0x799a820
y.create.l HWIO_QPIC_QPIC_BAM_P_FIFO_SIZES4_ADDR A:0x799b820
y.create.l HWIO_QPIC_QPIC_BAM_P_FIFO_SIZES5_ADDR A:0x799c820
y.create.l HWIO_QPIC_QPIC_BAM_P_FIFO_SIZES6_ADDR A:0x799d820
y.create.l HWIO_QPIC_QPIC_BAM_P_DATA_FIFO_ADDR0_ADDR A:0x7997824
y.create.l HWIO_QPIC_QPIC_BAM_P_DATA_FIFO_ADDR1_ADDR A:0x7998824
y.create.l HWIO_QPIC_QPIC_BAM_P_DATA_FIFO_ADDR2_ADDR A:0x7999824
y.create.l HWIO_QPIC_QPIC_BAM_P_DATA_FIFO_ADDR3_ADDR A:0x799a824
y.create.l HWIO_QPIC_QPIC_BAM_P_DATA_FIFO_ADDR4_ADDR A:0x799b824
y.create.l HWIO_QPIC_QPIC_BAM_P_DATA_FIFO_ADDR5_ADDR A:0x799c824
y.create.l HWIO_QPIC_QPIC_BAM_P_DATA_FIFO_ADDR6_ADDR A:0x799d824
y.create.l HWIO_QPIC_QPIC_BAM_P_EVNT_GEN_TRSHLD0_ADDR A:0x7997828
y.create.l HWIO_QPIC_QPIC_BAM_P_EVNT_GEN_TRSHLD1_ADDR A:0x7998828
y.create.l HWIO_QPIC_QPIC_BAM_P_EVNT_GEN_TRSHLD2_ADDR A:0x7999828
y.create.l HWIO_QPIC_QPIC_BAM_P_EVNT_GEN_TRSHLD3_ADDR A:0x799a828
y.create.l HWIO_QPIC_QPIC_BAM_P_EVNT_GEN_TRSHLD4_ADDR A:0x799b828
y.create.l HWIO_QPIC_QPIC_BAM_P_EVNT_GEN_TRSHLD5_ADDR A:0x799c828
y.create.l HWIO_QPIC_QPIC_BAM_P_EVNT_GEN_TRSHLD6_ADDR A:0x799d828
y.create.l HWIO_QPIC_QPIC_BAM_P_EVNT_DEST_ADDR0_ADDR A:0x799782c
y.create.l HWIO_QPIC_QPIC_BAM_P_EVNT_DEST_ADDR1_ADDR A:0x799882c
y.create.l HWIO_QPIC_QPIC_BAM_P_EVNT_DEST_ADDR2_ADDR A:0x799982c
y.create.l HWIO_QPIC_QPIC_BAM_P_EVNT_DEST_ADDR3_ADDR A:0x799a82c
y.create.l HWIO_QPIC_QPIC_BAM_P_EVNT_DEST_ADDR4_ADDR A:0x799b82c
y.create.l HWIO_QPIC_QPIC_BAM_P_EVNT_DEST_ADDR5_ADDR A:0x799c82c
y.create.l HWIO_QPIC_QPIC_BAM_P_EVNT_DEST_ADDR6_ADDR A:0x799d82c
y.create.l HWIO_QPIC_QPIC_BAM_P_DF_CNTXT_0_ADDR A:0x7997830
y.create.l HWIO_QPIC_QPIC_BAM_P_DF_CNTXT_1_ADDR A:0x7998830
y.create.l HWIO_QPIC_QPIC_BAM_P_DF_CNTXT_2_ADDR A:0x7999830
y.create.l HWIO_QPIC_QPIC_BAM_P_DF_CNTXT_3_ADDR A:0x799a830
y.create.l HWIO_QPIC_QPIC_BAM_P_DF_CNTXT_4_ADDR A:0x799b830
y.create.l HWIO_QPIC_QPIC_BAM_P_DF_CNTXT_5_ADDR A:0x799c830
y.create.l HWIO_QPIC_QPIC_BAM_P_DF_CNTXT_6_ADDR A:0x799d830
y.create.l HWIO_QPIC_QPIC_BAM_P_RETR_CNTXT_0_ADDR A:0x7997834
y.create.l HWIO_QPIC_QPIC_BAM_P_RETR_CNTXT_1_ADDR A:0x7998834
y.create.l HWIO_QPIC_QPIC_BAM_P_RETR_CNTXT_2_ADDR A:0x7999834
y.create.l HWIO_QPIC_QPIC_BAM_P_RETR_CNTXT_3_ADDR A:0x799a834
y.create.l HWIO_QPIC_QPIC_BAM_P_RETR_CNTXT_4_ADDR A:0x799b834
y.create.l HWIO_QPIC_QPIC_BAM_P_RETR_CNTXT_5_ADDR A:0x799c834
y.create.l HWIO_QPIC_QPIC_BAM_P_RETR_CNTXT_6_ADDR A:0x799d834
y.create.l HWIO_QPIC_QPIC_BAM_P_SI_CNTXT_0_ADDR A:0x7997838
y.create.l HWIO_QPIC_QPIC_BAM_P_SI_CNTXT_1_ADDR A:0x7998838
y.create.l HWIO_QPIC_QPIC_BAM_P_SI_CNTXT_2_ADDR A:0x7999838
y.create.l HWIO_QPIC_QPIC_BAM_P_SI_CNTXT_3_ADDR A:0x799a838
y.create.l HWIO_QPIC_QPIC_BAM_P_SI_CNTXT_4_ADDR A:0x799b838
y.create.l HWIO_QPIC_QPIC_BAM_P_SI_CNTXT_5_ADDR A:0x799c838
y.create.l HWIO_QPIC_QPIC_BAM_P_SI_CNTXT_6_ADDR A:0x799d838
y.create.l HWIO_QPIC_QPIC_BAM_P_PSM_CNTXT_3_LSB0_ADDR A:0x7997900
y.create.l HWIO_QPIC_QPIC_BAM_P_PSM_CNTXT_3_LSB1_ADDR A:0x7998900
y.create.l HWIO_QPIC_QPIC_BAM_P_PSM_CNTXT_3_LSB2_ADDR A:0x7999900
y.create.l HWIO_QPIC_QPIC_BAM_P_PSM_CNTXT_3_LSB3_ADDR A:0x799a900
y.create.l HWIO_QPIC_QPIC_BAM_P_PSM_CNTXT_3_LSB4_ADDR A:0x799b900
y.create.l HWIO_QPIC_QPIC_BAM_P_PSM_CNTXT_3_LSB5_ADDR A:0x799c900
y.create.l HWIO_QPIC_QPIC_BAM_P_PSM_CNTXT_3_LSB6_ADDR A:0x799d900
y.create.l HWIO_QPIC_QPIC_BAM_P_PSM_CNTXT_3_MSB0_ADDR A:0x7997904
y.create.l HWIO_QPIC_QPIC_BAM_P_PSM_CNTXT_3_MSB1_ADDR A:0x7998904
y.create.l HWIO_QPIC_QPIC_BAM_P_PSM_CNTXT_3_MSB2_ADDR A:0x7999904
y.create.l HWIO_QPIC_QPIC_BAM_P_PSM_CNTXT_3_MSB3_ADDR A:0x799a904
y.create.l HWIO_QPIC_QPIC_BAM_P_PSM_CNTXT_3_MSB4_ADDR A:0x799b904
y.create.l HWIO_QPIC_QPIC_BAM_P_PSM_CNTXT_3_MSB5_ADDR A:0x799c904
y.create.l HWIO_QPIC_QPIC_BAM_P_PSM_CNTXT_3_MSB6_ADDR A:0x799d904
y.create.l HWIO_QPIC_QPIC_BAM_P_DESC_FIFO_ADDR_LSB0_ADDR A:0x7997910
y.create.l HWIO_QPIC_QPIC_BAM_P_DESC_FIFO_ADDR_LSB1_ADDR A:0x7998910
y.create.l HWIO_QPIC_QPIC_BAM_P_DESC_FIFO_ADDR_LSB2_ADDR A:0x7999910
y.create.l HWIO_QPIC_QPIC_BAM_P_DESC_FIFO_ADDR_LSB3_ADDR A:0x799a910
y.create.l HWIO_QPIC_QPIC_BAM_P_DESC_FIFO_ADDR_LSB4_ADDR A:0x799b910
y.create.l HWIO_QPIC_QPIC_BAM_P_DESC_FIFO_ADDR_LSB5_ADDR A:0x799c910
y.create.l HWIO_QPIC_QPIC_BAM_P_DESC_FIFO_ADDR_LSB6_ADDR A:0x799d910
y.create.l HWIO_QPIC_QPIC_BAM_P_DESC_FIFO_ADDR_MSB0_ADDR A:0x7997914
y.create.l HWIO_QPIC_QPIC_BAM_P_DESC_FIFO_ADDR_MSB1_ADDR A:0x7998914
y.create.l HWIO_QPIC_QPIC_BAM_P_DESC_FIFO_ADDR_MSB2_ADDR A:0x7999914
y.create.l HWIO_QPIC_QPIC_BAM_P_DESC_FIFO_ADDR_MSB3_ADDR A:0x799a914
y.create.l HWIO_QPIC_QPIC_BAM_P_DESC_FIFO_ADDR_MSB4_ADDR A:0x799b914
y.create.l HWIO_QPIC_QPIC_BAM_P_DESC_FIFO_ADDR_MSB5_ADDR A:0x799c914
y.create.l HWIO_QPIC_QPIC_BAM_P_DESC_FIFO_ADDR_MSB6_ADDR A:0x799d914
y.create.l HWIO_QPIC_QPIC_BAM_P_DATA_FIFO_ADDR_LSB0_ADDR A:0x7997920
y.create.l HWIO_QPIC_QPIC_BAM_P_DATA_FIFO_ADDR_LSB1_ADDR A:0x7998920
y.create.l HWIO_QPIC_QPIC_BAM_P_DATA_FIFO_ADDR_LSB2_ADDR A:0x7999920
y.create.l HWIO_QPIC_QPIC_BAM_P_DATA_FIFO_ADDR_LSB3_ADDR A:0x799a920
y.create.l HWIO_QPIC_QPIC_BAM_P_DATA_FIFO_ADDR_LSB4_ADDR A:0x799b920
y.create.l HWIO_QPIC_QPIC_BAM_P_DATA_FIFO_ADDR_LSB5_ADDR A:0x799c920
y.create.l HWIO_QPIC_QPIC_BAM_P_DATA_FIFO_ADDR_LSB6_ADDR A:0x799d920
y.create.l HWIO_QPIC_QPIC_BAM_P_DATA_FIFO_ADDR_MSB0_ADDR A:0x7997924
y.create.l HWIO_QPIC_QPIC_BAM_P_DATA_FIFO_ADDR_MSB1_ADDR A:0x7998924
y.create.l HWIO_QPIC_QPIC_BAM_P_DATA_FIFO_ADDR_MSB2_ADDR A:0x7999924
y.create.l HWIO_QPIC_QPIC_BAM_P_DATA_FIFO_ADDR_MSB3_ADDR A:0x799a924
y.create.l HWIO_QPIC_QPIC_BAM_P_DATA_FIFO_ADDR_MSB4_ADDR A:0x799b924
y.create.l HWIO_QPIC_QPIC_BAM_P_DATA_FIFO_ADDR_MSB5_ADDR A:0x799c924
y.create.l HWIO_QPIC_QPIC_BAM_P_DATA_FIFO_ADDR_MSB6_ADDR A:0x799d924
y.create.l HWIO_QPIC_QPIC_BAM_P_EVNT_DEST_ADDR_LSB0_ADDR A:0x7997930
y.create.l HWIO_QPIC_QPIC_BAM_P_EVNT_DEST_ADDR_LSB1_ADDR A:0x7998930
y.create.l HWIO_QPIC_QPIC_BAM_P_EVNT_DEST_ADDR_LSB2_ADDR A:0x7999930
y.create.l HWIO_QPIC_QPIC_BAM_P_EVNT_DEST_ADDR_LSB3_ADDR A:0x799a930
y.create.l HWIO_QPIC_QPIC_BAM_P_EVNT_DEST_ADDR_LSB4_ADDR A:0x799b930
y.create.l HWIO_QPIC_QPIC_BAM_P_EVNT_DEST_ADDR_LSB5_ADDR A:0x799c930
y.create.l HWIO_QPIC_QPIC_BAM_P_EVNT_DEST_ADDR_LSB6_ADDR A:0x799d930
y.create.l HWIO_QPIC_QPIC_BAM_P_EVNT_DEST_ADDR_MSB0_ADDR A:0x7997934
y.create.l HWIO_QPIC_QPIC_BAM_P_EVNT_DEST_ADDR_MSB1_ADDR A:0x7998934
y.create.l HWIO_QPIC_QPIC_BAM_P_EVNT_DEST_ADDR_MSB2_ADDR A:0x7999934
y.create.l HWIO_QPIC_QPIC_BAM_P_EVNT_DEST_ADDR_MSB3_ADDR A:0x799a934
y.create.l HWIO_QPIC_QPIC_BAM_P_EVNT_DEST_ADDR_MSB4_ADDR A:0x799b934
y.create.l HWIO_QPIC_QPIC_BAM_P_EVNT_DEST_ADDR_MSB5_ADDR A:0x799c934
y.create.l HWIO_QPIC_QPIC_BAM_P_EVNT_DEST_ADDR_MSB6_ADDR A:0x799d934
y.create.l HWIO_QPIC_QPIC_XPU_SCR_ADDR A:0x7982000
y.create.l HWIO_QPIC_QPIC_XPU_SWDR_ADDR A:0x7982004
y.create.l HWIO_QPIC_QPIC_XPU_SEAR0_ADDR A:0x7982040
y.create.l HWIO_QPIC_QPIC_XPU_SESR_ADDR A:0x7982048
y.create.l HWIO_QPIC_QPIC_XPU_SESRRESTORE_ADDR A:0x798204c
y.create.l HWIO_QPIC_QPIC_XPU_SESYNR0_ADDR A:0x7982050
y.create.l HWIO_QPIC_QPIC_XPU_SESYNR1_ADDR A:0x7982054
y.create.l HWIO_QPIC_QPIC_XPU_SESYNR2_ADDR A:0x7982058
y.create.l HWIO_QPIC_QPIC_XPU_MCR_ADDR A:0x7982100
y.create.l HWIO_QPIC_QPIC_XPU_MEAR0_ADDR A:0x7982140
y.create.l HWIO_QPIC_QPIC_XPU_MESR_ADDR A:0x7982148
y.create.l HWIO_QPIC_QPIC_XPU_MESRRESTORE_ADDR A:0x798214c
y.create.l HWIO_QPIC_QPIC_XPU_MESYNR0_ADDR A:0x7982150
y.create.l HWIO_QPIC_QPIC_XPU_MESYNR1_ADDR A:0x7982154
y.create.l HWIO_QPIC_QPIC_XPU_MESYNR2_ADDR A:0x7982158
y.create.l HWIO_QPIC_QPIC_XPU_CR_ADDR A:0x7982080
y.create.l HWIO_QPIC_QPIC_XPU_RPU_ACR0_ADDR A:0x79820a0
y.create.l HWIO_QPIC_QPIC_XPU_EAR0_ADDR A:0x79820c0
y.create.l HWIO_QPIC_QPIC_XPU_ESR_ADDR A:0x79820c8
y.create.l HWIO_QPIC_QPIC_XPU_ESRRESTORE_ADDR A:0x79820cc
y.create.l HWIO_QPIC_QPIC_XPU_ESYNR0_ADDR A:0x79820d0
y.create.l HWIO_QPIC_QPIC_XPU_ESYNR1_ADDR A:0x79820d4
y.create.l HWIO_QPIC_QPIC_XPU_ESYNR2_ADDR A:0x79820d8
y.create.l HWIO_QPIC_QPIC_XPU_IDR0_ADDR A:0x7982074
y.create.l HWIO_QPIC_QPIC_XPU_IDR1_ADDR A:0x7982078
y.create.l HWIO_QPIC_QPIC_XPU_REV_ADDR A:0x798207c
y.create.l HWIO_QPIC_QPIC_XPU_RG0_RACR0_ADDR A:0x7982200
y.create.l HWIO_QPIC_QPIC_XPU_RG1_RACR0_ADDR A:0x7982280
y.create.l HWIO_QPIC_QPIC_XPU_RG2_RACR0_ADDR A:0x7982300
y.create.l HWIO_QPIC_QPIC_XPU_RG3_RACR0_ADDR A:0x7982380
y.create.l HWIO_QPIC_QPIC_XPU_RG4_RACR0_ADDR A:0x7982400
y.create.l HWIO_QPIC_QPIC_XPU_RG5_RACR0_ADDR A:0x7982480
y.create.l HWIO_QPIC_QPIC_XPU_RG6_RACR0_ADDR A:0x7982500
y.create.l HWIO_QPIC_QPIC_XPU_RG7_RACR0_ADDR A:0x7982580
y.create.l HWIO_QPIC_QPIC_XPU_RG8_RACR0_ADDR A:0x7982600
y.create.l HWIO_QPIC_QPIC_XPU_RG9_RACR0_ADDR A:0x7982680
y.create.l HWIO_QPIC_QPIC_XPU_RG0_SCR_ADDR A:0x7982250
y.create.l HWIO_QPIC_QPIC_XPU_RG1_SCR_ADDR A:0x79822d0
y.create.l HWIO_QPIC_QPIC_XPU_RG2_SCR_ADDR A:0x7982350
y.create.l HWIO_QPIC_QPIC_XPU_RG3_SCR_ADDR A:0x79823d0
y.create.l HWIO_QPIC_QPIC_XPU_RG4_SCR_ADDR A:0x7982450
y.create.l HWIO_QPIC_QPIC_XPU_RG5_SCR_ADDR A:0x79824d0
y.create.l HWIO_QPIC_QPIC_XPU_RG6_SCR_ADDR A:0x7982550
y.create.l HWIO_QPIC_QPIC_XPU_RG7_SCR_ADDR A:0x79825d0
y.create.l HWIO_QPIC_QPIC_XPU_RG8_SCR_ADDR A:0x7982650
y.create.l HWIO_QPIC_QPIC_XPU_RG9_SCR_ADDR A:0x79826d0
y.create.l HWIO_QPIC_QPIC_XPU_RG0_MCR_ADDR A:0x7982254
y.create.l HWIO_QPIC_QPIC_XPU_RG1_MCR_ADDR A:0x79822d4
y.create.l HWIO_QPIC_QPIC_XPU_RG2_MCR_ADDR A:0x7982354
y.create.l HWIO_QPIC_QPIC_XPU_RG3_MCR_ADDR A:0x79823d4
y.create.l HWIO_QPIC_QPIC_XPU_RG4_MCR_ADDR A:0x7982454
y.create.l HWIO_QPIC_QPIC_XPU_RG5_MCR_ADDR A:0x79824d4
y.create.l HWIO_QPIC_QPIC_XPU_RG6_MCR_ADDR A:0x7982554
y.create.l HWIO_QPIC_QPIC_XPU_RG7_MCR_ADDR A:0x79825d4
y.create.l HWIO_QPIC_QPIC_XPU_RG8_MCR_ADDR A:0x7982654
y.create.l HWIO_QPIC_QPIC_XPU_RG9_MCR_ADDR A:0x79826d4
y.create.l HWIO_QPIC_QPIC_VMIDMT_SCR0_ADDR A:0x7980000
y.create.l HWIO_QPIC_QPIC_VMIDMT_SCR1_ADDR A:0x7980004
y.create.l HWIO_QPIC_QPIC_VMIDMT_SCR2_ADDR A:0x7980008
y.create.l HWIO_QPIC_QPIC_VMIDMT_SACR_ADDR A:0x7980010
y.create.l HWIO_QPIC_QPIC_VMIDMT_SIDR0_ADDR A:0x7980020
y.create.l HWIO_QPIC_QPIC_VMIDMT_SIDR1_ADDR A:0x7980024
y.create.l HWIO_QPIC_QPIC_VMIDMT_SIDR2_ADDR A:0x7980028
y.create.l HWIO_QPIC_QPIC_VMIDMT_SIDR4_ADDR A:0x7980030
y.create.l HWIO_QPIC_QPIC_VMIDMT_SIDR5_ADDR A:0x7980034
y.create.l HWIO_QPIC_QPIC_VMIDMT_SIDR7_ADDR A:0x798003c
y.create.l HWIO_QPIC_QPIC_VMIDMT_SGFAR0_ADDR A:0x7980040
y.create.l HWIO_QPIC_QPIC_VMIDMT_SGFSR_ADDR A:0x7980048
y.create.l HWIO_QPIC_QPIC_VMIDMT_SGFSRRESTORE_ADDR A:0x798004c
y.create.l HWIO_QPIC_QPIC_VMIDMT_SGFSYNDR0_ADDR A:0x7980050
y.create.l HWIO_QPIC_QPIC_VMIDMT_SGFSYNDR1_ADDR A:0x7980054
y.create.l HWIO_QPIC_QPIC_VMIDMT_SGFSYNDR2_ADDR A:0x7980058
y.create.l HWIO_QPIC_QPIC_VMIDMT_VMIDMTSCR0_ADDR A:0x7980090
y.create.l HWIO_QPIC_QPIC_VMIDMT_CR0_ADDR A:0x7980000
y.create.l HWIO_QPIC_QPIC_VMIDMT_CR2_ADDR A:0x7980008
y.create.l HWIO_QPIC_QPIC_VMIDMT_ACR_ADDR A:0x7980010
y.create.l HWIO_QPIC_QPIC_VMIDMT_IDR0_ADDR A:0x7980020
y.create.l HWIO_QPIC_QPIC_VMIDMT_IDR1_ADDR A:0x7980024
y.create.l HWIO_QPIC_QPIC_VMIDMT_IDR2_ADDR A:0x7980028
y.create.l HWIO_QPIC_QPIC_VMIDMT_IDR4_ADDR A:0x7980030
y.create.l HWIO_QPIC_QPIC_VMIDMT_IDR5_ADDR A:0x7980034
y.create.l HWIO_QPIC_QPIC_VMIDMT_IDR7_ADDR A:0x798003c
y.create.l HWIO_QPIC_QPIC_VMIDMT_GFAR0_ADDR A:0x7980040
y.create.l HWIO_QPIC_QPIC_VMIDMT_GFSR_ADDR A:0x7980048
y.create.l HWIO_QPIC_QPIC_VMIDMT_GFSRRESTORE_ADDR A:0x798004c
y.create.l HWIO_QPIC_QPIC_VMIDMT_GFSYNDR0_ADDR A:0x7980050
y.create.l HWIO_QPIC_QPIC_VMIDMT_GFSYNDR1_ADDR A:0x7980054
y.create.l HWIO_QPIC_QPIC_VMIDMT_GFSYNDR2_ADDR A:0x7980058
y.create.l HWIO_QPIC_QPIC_VMIDMT_VMIDMTCR0_ADDR A:0x7980090
y.create.l HWIO_QPIC_QPIC_VMIDMT_VMIDMTACR_ADDR A:0x798009c
y.create.l HWIO_QPIC_QPIC_VMIDMT_NSCR0_ADDR A:0x7980400
y.create.l HWIO_QPIC_QPIC_VMIDMT_NSCR2_ADDR A:0x7980408
y.create.l HWIO_QPIC_QPIC_VMIDMT_NSACR_ADDR A:0x7980410
y.create.l HWIO_QPIC_QPIC_VMIDMT_NSGFAR0_ADDR A:0x7980440
y.create.l HWIO_QPIC_QPIC_VMIDMT_NSGFSR_ADDR A:0x7980448
y.create.l HWIO_QPIC_QPIC_VMIDMT_NSGFSRRESTORE_ADDR A:0x798044c
y.create.l HWIO_QPIC_QPIC_VMIDMT_NSGFSYNDR0_ADDR A:0x7980450
y.create.l HWIO_QPIC_QPIC_VMIDMT_NSGFSYNDR1_ADDR A:0x7980454
y.create.l HWIO_QPIC_QPIC_VMIDMT_NSGFSYNDR2_ADDR A:0x7980458
y.create.l HWIO_QPIC_QPIC_VMIDMT_NSVMIDMTCR0_ADDR A:0x7980490
y.create.l HWIO_QPIC_QPIC_VMIDMT_SSDR0_ADDR A:0x7980080
y.create.l HWIO_QPIC_QPIC_VMIDMT_MSDR0_ADDR A:0x7980480
y.create.l HWIO_QPIC_QPIC_VMIDMT_MCR_ADDR A:0x7980494
y.create.l HWIO_QPIC_QPIC_VMIDMT_S2VR0_ADDR A:0x7980c00
y.create.l HWIO_QPIC_QPIC_VMIDMT_S2VR1_ADDR A:0x7980c04
y.create.l HWIO_QPIC_QPIC_VMIDMT_S2VR2_ADDR A:0x7980c08
y.create.l HWIO_QPIC_QPIC_VMIDMT_S2VR3_ADDR A:0x7980c0c
y.create.l HWIO_QPIC_QPIC_VMIDMT_S2VR4_ADDR A:0x7980c10
y.create.l HWIO_QPIC_QPIC_VMIDMT_S2VR5_ADDR A:0x7980c14
y.create.l HWIO_QPIC_QPIC_VMIDMT_S2VR6_ADDR A:0x7980c18
y.create.l HWIO_QPIC_QPIC_VMIDMT_S2VR7_ADDR A:0x7980c1c
y.create.l HWIO_QPIC_QPIC_VMIDMT_AS2VR0_ADDR A:0x7980e00
y.create.l HWIO_QPIC_QPIC_VMIDMT_AS2VR1_ADDR A:0x7980e04
y.create.l HWIO_QPIC_QPIC_VMIDMT_AS2VR2_ADDR A:0x7980e08
y.create.l HWIO_QPIC_QPIC_VMIDMT_AS2VR3_ADDR A:0x7980e0c
y.create.l HWIO_QPIC_QPIC_VMIDMT_AS2VR4_ADDR A:0x7980e10
y.create.l HWIO_QPIC_QPIC_VMIDMT_AS2VR5_ADDR A:0x7980e14
y.create.l HWIO_QPIC_QPIC_VMIDMT_AS2VR6_ADDR A:0x7980e18
y.create.l HWIO_QPIC_QPIC_VMIDMT_AS2VR7_ADDR A:0x7980e1c
y.create.l HWIO_QPIC_QPIC_VMIDMT_SMR0_ADDR A:0x7980800
y.create.l HWIO_QPIC_QPIC_VMIDMT_SMR1_ADDR A:0x7980804
y.create.l HWIO_QPIC_QPIC_VMIDMT_SMR2_ADDR A:0x7980808
y.create.l HWIO_QPIC_QPIC_VMIDMT_SMR3_ADDR A:0x798080c
y.create.l HWIO_QPIC_QPIC_VMIDMT_SMR4_ADDR A:0x7980810
y.create.l HWIO_QPIC_QPIC_VMIDMT_SMR5_ADDR A:0x7980814
y.create.l HWIO_QPIC_QPIC_VMIDMT_SMR6_ADDR A:0x7980818
y.create.l HWIO_QPIC_QPIC_VMIDMT_SMR7_ADDR A:0x798081c
y.create.l HWIO_QPIC_EBI2_CHIP_SELECT_CFG0_ADDR A:0x79a0000
y.create.l HWIO_QPIC_EBI2_CFG_ADDR A:0x79a0004
y.create.l HWIO_QPIC_EBI2_ARBITER_CFG_ADDR A:0x79a0030
y.create.l HWIO_QPIC_EBI2_DEBUG_REG_LSB_ADDR A:0x79a0048
y.create.l HWIO_QPIC_EBI2_DEBUG_REG_MSB_ADDR A:0x79a004c
y.create.l HWIO_QPIC_EBI2_DEBUG_SEL_ADDR A:0x79a0050
y.create.l HWIO_QPIC_EBI2_CRC_CFG_ADDR A:0x79a0054
y.create.l HWIO_QPIC_EBI2_CRC_REMINDER_CFG_ADDR A:0x79a0058
y.create.l HWIO_QPIC_EBI2_NAND_ADM_MUX_ADDR A:0x79a005c
y.create.l HWIO_QPIC_EBI2_CLKON_CFG_ADDR A:0x79a0068
y.create.l HWIO_QPIC_EBI2_CORE_CLKON_CFG_ADDR A:0x79a006c
y.create.l HWIO_QPIC_QPIC_LCDC_CTRL_ADDR A:0x79a2000
y.create.l HWIO_QPIC_LCDC_VERSION_ADDR A:0x79a2004
y.create.l HWIO_QPIC_QPIC_LCDC_IRQ_EN_ADDR A:0x79a2008
y.create.l HWIO_QPIC_QPIC_LCDC_IRQ_STTS_ADDR A:0x79a200c
y.create.l HWIO_QPIC_QPIC_LCDC_IRQ_CLR_ADDR A:0x79a2010
y.create.l HWIO_QPIC_QPIC_LCDC_STTS_ADDR A:0x79a2014
y.create.l HWIO_QPIC_QPIC_LCDC_CMD_DATA_CYCLE_CNT_ADDR A:0x79a2018
y.create.l HWIO_QPIC_QPIC_LCDC_CFG0_ADDR A:0x79a2020
y.create.l HWIO_QPIC_QPIC_LCDC_CFG1_ADDR A:0x79a2024
y.create.l HWIO_QPIC_QPIC_LCDC_CFG2_ADDR A:0x79a2028
y.create.l HWIO_QPIC_QPIC_LCDC_RESET_ADDR A:0x79a202c
y.create.l HWIO_QPIC_QPIC_LCD_DEVICE_RESET_ADDR A:0x79a2030
y.create.l HWIO_QPIC_QPIC_LCDC_FIFO_SOF_ADDR A:0x79a2100
y.create.l HWIO_QPIC_QPIC_LCDC_FIFO_DATA_PORT0_ADDR A:0x79a2140
y.create.l HWIO_QPIC_QPIC_LCDC_FIFO_DATA_PORT1_ADDR A:0x79a2144
y.create.l HWIO_QPIC_QPIC_LCDC_FIFO_DATA_PORT2_ADDR A:0x79a2148
y.create.l HWIO_QPIC_QPIC_LCDC_FIFO_DATA_PORT3_ADDR A:0x79a214c
y.create.l HWIO_QPIC_QPIC_LCDC_FIFO_DATA_PORT4_ADDR A:0x79a2150
y.create.l HWIO_QPIC_QPIC_LCDC_FIFO_DATA_PORT5_ADDR A:0x79a2154
y.create.l HWIO_QPIC_QPIC_LCDC_FIFO_DATA_PORT6_ADDR A:0x79a2158
y.create.l HWIO_QPIC_QPIC_LCDC_FIFO_DATA_PORT7_ADDR A:0x79a215c
y.create.l HWIO_QPIC_QPIC_LCDC_FIFO_DATA_PORT8_ADDR A:0x79a2160
y.create.l HWIO_QPIC_QPIC_LCDC_FIFO_DATA_PORT9_ADDR A:0x79a2164
y.create.l HWIO_QPIC_QPIC_LCDC_FIFO_EOF_ADDR A:0x79a2180
y.create.l HWIO_QPIC_LCD_DEVICE_CMD0_ADDR A:0x79a3000
y.create.l HWIO_QPIC_LCD_DEVICE_CMD1_ADDR A:0x79a3004
y.create.l HWIO_QPIC_LCD_DEVICE_CMD2_ADDR A:0x79a3008
y.create.l HWIO_QPIC_LCD_DEVICE_CMD3_ADDR A:0x79a300c
y.create.l HWIO_QPIC_LCD_DEVICE_CMD4_ADDR A:0x79a3010
y.create.l HWIO_QPIC_LCD_DEVICE_CMD5_ADDR A:0x79a3014
y.create.l HWIO_QPIC_LCD_DEVICE_CMD6_ADDR A:0x79a3018
y.create.l HWIO_QPIC_LCD_DEVICE_CMD7_ADDR A:0x79a301c
y.create.l HWIO_QPIC_LCD_DEVICE_CMD8_ADDR A:0x79a3020
y.create.l HWIO_QPIC_LCD_DEVICE_CMD9_ADDR A:0x79a3024
y.create.l HWIO_QPIC_QPIC_VERSION_ADDR A:0x79a0100
y.create.l HWIO_QPIC_QPIC_CTRL_ADDR A:0x79a0104
y.create.l HWIO_QPIC_QPIC_HW_INFO_ADDR A:0x79a0108
y.create.l HWIO_QPIC_QPIC_REG_PERMISSION_ADDR A:0x79a010c
y.create.l HWIO_QPIC_QPIC_DEBUG_ADDR A:0x79a0110
y.create.l HWIO_QPIC_QPIC_HW_GENERICS_ADDR A:0x79a0114
y.create.l HWIO_QPIC_NAND_FLASH_CMD_ADDR A:0x79b0000
y.create.l HWIO_QPIC_NAND_ADDR0_ADDR A:0x79b0004
y.create.l HWIO_QPIC_NAND_ADDR1_ADDR A:0x79b0008
y.create.l HWIO_QPIC_NAND_FLASH_CHIP_SELECT_ADDR A:0x79b000c
y.create.l HWIO_QPIC_NANDC_EXEC_CMD_ADDR A:0x79b0010
y.create.l HWIO_QPIC_NAND_FLASH_STATUS_ADDR A:0x79b0014
y.create.l HWIO_QPIC_NANDC_BUFFER_STATUS_ADDR A:0x79b0018
y.create.l HWIO_QPIC_NAND_DEV0_CFG0_ADDR A:0x79b0020
y.create.l HWIO_QPIC_NAND_DEV1_CFG0_ADDR A:0x79b0030
y.create.l HWIO_QPIC_NAND_DEV0_CFG1_ADDR A:0x79b0024
y.create.l HWIO_QPIC_NAND_DEV1_CFG1_ADDR A:0x79b0034
y.create.l HWIO_QPIC_NAND_DEV0_ECC_CFG_ADDR A:0x79b0028
y.create.l HWIO_QPIC_NAND_DEV1_ECC_CFG_ADDR A:0x79b002c
y.create.l HWIO_QPIC_NAND_FLASH_READ_ID_ADDR A:0x79b0040
y.create.l HWIO_QPIC_NAND_FLASH_READ_ID2_ADDR A:0x79b0048
y.create.l HWIO_QPIC_NAND_FLASH_READ_STATUS_ADDR A:0x79b0044
y.create.l HWIO_QPIC_NAND_FLASH_CONFIG_DATA_ADDR A:0x79b0050
y.create.l HWIO_QPIC_NAND_FLASH_CONFIG_ADDR A:0x79b0054
y.create.l HWIO_QPIC_NAND_FLASH_CONFIG_MODE_ADDR A:0x79b0058
y.create.l HWIO_QPIC_NAND_FLASH_CONFIG_STATUS_ADDR A:0x79b0060
y.create.l HWIO_QPIC_FLASH_MACRO1_REG_ADDR A:0x79b0064
y.create.l HWIO_QPIC_HSDDR_NAND_CFG_ADDR A:0x79b0068
y.create.l HWIO_QPIC_FLASH_XFR_STEP1_ADDR A:0x79b0070
y.create.l HWIO_QPIC_FLASH_XFR_STEP2_ADDR A:0x79b0074
y.create.l HWIO_QPIC_FLASH_XFR_STEP3_ADDR A:0x79b0078
y.create.l HWIO_QPIC_FLASH_XFR_STEP4_ADDR A:0x79b007c
y.create.l HWIO_QPIC_FLASH_XFR_STEP5_ADDR A:0x79b0080
y.create.l HWIO_QPIC_FLASH_XFR_STEP6_ADDR A:0x79b0084
y.create.l HWIO_QPIC_FLASH_XFR_STEP7_ADDR A:0x79b0088
y.create.l HWIO_QPIC_NAND_GENP_REG0_ADDR A:0x79b0090
y.create.l HWIO_QPIC_NAND_GENP_REG1_ADDR A:0x79b0094
y.create.l HWIO_QPIC_NAND_GENP_REG2_ADDR A:0x79b0098
y.create.l HWIO_QPIC_NAND_GENP_REG3_ADDR A:0x79b009c
y.create.l HWIO_QPIC_FLASH_DEV_CMD0_ADDR A:0x79b00a0
y.create.l HWIO_QPIC_FLASH_DEV_CMD1_ADDR A:0x79b00a4
y.create.l HWIO_QPIC_FLASH_DEV_CMD2_ADDR A:0x79b00a8
y.create.l HWIO_QPIC_FLASH_DEV_CMD_VLD_ADDR A:0x79b00ac
y.create.l HWIO_QPIC_NAND_ADDR2_ADDR A:0x79b00c0
y.create.l HWIO_QPIC_NAND_ADDR3_ADDR A:0x79b00c4
y.create.l HWIO_QPIC_NAND_ADDR4_ADDR A:0x79b00c8
y.create.l HWIO_QPIC_NAND_ADDR5_ADDR A:0x79b00cc
y.create.l HWIO_QPIC_FLASH_DEV_CMD3_ADDR A:0x79b00d0
y.create.l HWIO_QPIC_FLASH_DEV_CMD4_ADDR A:0x79b00d4
y.create.l HWIO_QPIC_FLASH_DEV_CMD5_ADDR A:0x79b00d8
y.create.l HWIO_QPIC_FLASH_DEV_CMD6_ADDR A:0x79b00dc
y.create.l HWIO_QPIC_NAND_ADDR6_ADDR A:0x79b00e4
y.create.l HWIO_QPIC_NAND_ERASED_CW_DETECT_CFG_ADDR A:0x79b00e8
y.create.l HWIO_QPIC_NAND_ERASED_CW_DETECT_STATUS_ADDR A:0x79b00ec
y.create.l HWIO_QPIC_EBI2_ECC_BUF_CFG_ADDR A:0x79b00f0
y.create.l HWIO_QPIC_NANDC_DBG_CFG_ADDR A:0x79b00f4
y.create.l HWIO_QPIC_NANDC_HW_PROFILE_CFG_ADDR A:0x79b00f8
y.create.l HWIO_QPIC_FLASH_BUFF0_ACC_ADDR A:0x79b0100
y.create.l HWIO_QPIC_FLASH_BUFF1_ACC_ADDR A:0x79b0104
y.create.l HWIO_QPIC_FLASH_BUFF2_ACC_ADDR A:0x79b0108
y.create.l HWIO_QPIC_FLASH_BUFF3_ACC_ADDR A:0x79b010c
y.create.l HWIO_QPIC_FLASH_BUFF4_ACC_ADDR A:0x79b0110
y.create.l HWIO_QPIC_FLASH_BUFF5_ACC_ADDR A:0x79b0114
y.create.l HWIO_QPIC_FLASH_BUFF6_ACC_ADDR A:0x79b0118
y.create.l HWIO_QPIC_FLASH_BUFF7_ACC_ADDR A:0x79b011c
y.create.l HWIO_QPIC_FLASH_BUFF8_ACC_ADDR A:0x79b0120
y.create.l HWIO_QPIC_FLASH_BUFF9_ACC_ADDR A:0x79b0124
y.create.l HWIO_QPIC_NAND_CTRL_ADDR A:0x79b0f00
y.create.l HWIO_QPIC_NAND_STATUS_ADDR A:0x79b0f04
y.create.l HWIO_QPIC_NAND_VERSION_ADDR A:0x79b0f08
y.create.l HWIO_QPIC_NAND_MPU_BYPASS_ADDR A:0x79b0f44
y.create.l HWIO_QPIC_NAND_DEBUG_ADDR A:0x79b0f0c
y.create.l HWIO_QPIC_NAND_IRQ_STTS_ADDR A:0x79b0f10
y.create.l HWIO_QPIC_NAND_IRQ_CLR_ADDR A:0x79b0f14
y.create.l HWIO_QPIC_NAND_IRQ_EN_ADDR A:0x79b0f18
y.create.l HWIO_QPIC_NAND_MUTEX_ADDR A:0x79b0f1c
y.create.l HWIO_QPIC_NAND_CONFIG_BITS_ADDR A:0x79b0f40
y.create.l HWIO_QPIC_NAND_READ_LOCATION_0_ADDR A:0x79b0f20
y.create.l HWIO_QPIC_NAND_READ_LOCATION_1_ADDR A:0x79b0f24
y.create.l HWIO_QPIC_NAND_READ_LOCATION_2_ADDR A:0x79b0f28
y.create.l HWIO_QPIC_NAND_READ_LOCATION_3_ADDR A:0x79b0f2c
y.create.l HWIO_QPIC_NAND_READ_LOCATION_4_ADDR A:0x79b0f30
y.create.l HWIO_QPIC_NAND_TEST_BUS_LSB_ADDR A:0x79b0f48
y.create.l HWIO_QPIC_NAND_TEST_BUS_MSB_ADDR A:0x79b0f4c
y.create.l HWIO_QPIC_NAND_OP_DONE_CNT_ADDR A:0x79b0f50
y.create.l HWIO_QPIC_NAND_ERR_RESP_TIME_OUT_ADDR A:0x79b0f54
y.create.l HWIO_QPIC_QPIC_MPU_XPU_SCR_ADDR A:0x79b1000
y.create.l HWIO_QPIC_QPIC_MPU_XPU_SWDR_ADDR A:0x79b1004
y.create.l HWIO_QPIC_QPIC_MPU_XPU_PRTN_RACR_SSHADOW_ADDR A:0x79b1008
y.create.l HWIO_QPIC_QPIC_MPU_XPU_PRTN_WACR_SSHADOW_ADDR A:0x79b100c
y.create.l HWIO_QPIC_QPIC_MPU_XPU_PRTN_START_SSHADOW0_ADDR A:0x79b1010
y.create.l HWIO_QPIC_QPIC_MPU_XPU_PRTN_START_SSHADOW1_ADDR A:0x79b1014
y.create.l HWIO_QPIC_QPIC_MPU_XPU_PRTN_END_SSHADOW0_ADDR A:0x79b1018
y.create.l HWIO_QPIC_QPIC_MPU_XPU_PRTN_END_SSHADOW1_ADDR A:0x79b101c
y.create.l HWIO_QPIC_QPIC_MPU_XPU_SEAR0_ADDR A:0x79b1040
y.create.l HWIO_QPIC_QPIC_MPU_XPU_SEAR1_ADDR A:0x79b1044
y.create.l HWIO_QPIC_QPIC_MPU_XPU_SESR_ADDR A:0x79b1048
y.create.l HWIO_QPIC_QPIC_MPU_XPU_SESRRESTORE_ADDR A:0x79b104c
y.create.l HWIO_QPIC_QPIC_MPU_XPU_SESYNR0_ADDR A:0x79b1050
y.create.l HWIO_QPIC_QPIC_MPU_XPU_SESYNR1_ADDR A:0x79b1054
y.create.l HWIO_QPIC_QPIC_MPU_XPU_SESYNR2_ADDR A:0x79b1058
y.create.l HWIO_QPIC_QPIC_MPU_XPU_MCR_ADDR A:0x79b1100
y.create.l HWIO_QPIC_QPIC_MPU_XPU_MEAR0_ADDR A:0x79b1140
y.create.l HWIO_QPIC_QPIC_MPU_XPU_MEAR1_ADDR A:0x79b1144
y.create.l HWIO_QPIC_QPIC_MPU_XPU_MESR_ADDR A:0x79b1148
y.create.l HWIO_QPIC_QPIC_MPU_XPU_MESRRESTORE_ADDR A:0x79b114c
y.create.l HWIO_QPIC_QPIC_MPU_XPU_MESYNR0_ADDR A:0x79b1150
y.create.l HWIO_QPIC_QPIC_MPU_XPU_MESYNR1_ADDR A:0x79b1154
y.create.l HWIO_QPIC_QPIC_MPU_XPU_MESYNR2_ADDR A:0x79b1158
y.create.l HWIO_QPIC_QPIC_MPU_XPU_CR_ADDR A:0x79b1080
y.create.l HWIO_QPIC_QPIC_MPU_XPU_PRTN_RACR_SHADOW_ADDR A:0x79b1088
y.create.l HWIO_QPIC_QPIC_MPU_XPU_PRTN_WACR_SHADOW_ADDR A:0x79b108c
y.create.l HWIO_QPIC_QPIC_MPU_XPU_PRTN_START_SHADOW0_ADDR A:0x79b1090
y.create.l HWIO_QPIC_QPIC_MPU_XPU_PRTN_START_SHADOW1_ADDR A:0x79b1094
y.create.l HWIO_QPIC_QPIC_MPU_XPU_PRTN_END_SHADOW0_ADDR A:0x79b1098
y.create.l HWIO_QPIC_QPIC_MPU_XPU_PRTN_END_SHADOW1_ADDR A:0x79b109c
y.create.l HWIO_QPIC_QPIC_MPU_XPU_RPU_ACR0_ADDR A:0x79b10a0
y.create.l HWIO_QPIC_QPIC_MPU_XPU_EAR0_ADDR A:0x79b10c0
y.create.l HWIO_QPIC_QPIC_MPU_XPU_EAR1_ADDR A:0x79b10c4
y.create.l HWIO_QPIC_QPIC_MPU_XPU_ESR_ADDR A:0x79b10c8
y.create.l HWIO_QPIC_QPIC_MPU_XPU_ESRRESTORE_ADDR A:0x79b10cc
y.create.l HWIO_QPIC_QPIC_MPU_XPU_ESYNR0_ADDR A:0x79b10d0
y.create.l HWIO_QPIC_QPIC_MPU_XPU_ESYNR1_ADDR A:0x79b10d4
y.create.l HWIO_QPIC_QPIC_MPU_XPU_ESYNR2_ADDR A:0x79b10d8
y.create.l HWIO_QPIC_QPIC_MPU_XPU_UMR_RACR_ADDR A:0x79b10e0
y.create.l HWIO_QPIC_QPIC_MPU_XPU_UMR_WACR_ADDR A:0x79b10e4
y.create.l HWIO_QPIC_QPIC_MPU_XPU_UMR_CNTL_ADDR A:0x79b10f0
y.create.l HWIO_QPIC_QPIC_MPU_XPU_IDR0_ADDR A:0x79b1074
y.create.l HWIO_QPIC_QPIC_MPU_XPU_IDR1_ADDR A:0x79b1078
y.create.l HWIO_QPIC_QPIC_MPU_XPU_REV_ADDR A:0x79b107c
y.create.l HWIO_QPIC_QPIC_MPU_XPU_PRT0_RACR0_ADDR A:0x79b1200
y.create.l HWIO_QPIC_QPIC_MPU_XPU_PRT1_RACR0_ADDR A:0x79b1280
y.create.l HWIO_QPIC_QPIC_MPU_XPU_PRT2_RACR0_ADDR A:0x79b1300
y.create.l HWIO_QPIC_QPIC_MPU_XPU_PRT3_RACR0_ADDR A:0x79b1380
y.create.l HWIO_QPIC_QPIC_MPU_XPU_PRT4_RACR0_ADDR A:0x79b1400
y.create.l HWIO_QPIC_QPIC_MPU_XPU_PRT5_RACR0_ADDR A:0x79b1480
y.create.l HWIO_QPIC_QPIC_MPU_XPU_PRT6_RACR0_ADDR A:0x79b1500
y.create.l HWIO_QPIC_QPIC_MPU_XPU_PRT7_RACR0_ADDR A:0x79b1580
y.create.l HWIO_QPIC_QPIC_MPU_XPU_PRT0_WACR0_ADDR A:0x79b1220
y.create.l HWIO_QPIC_QPIC_MPU_XPU_PRT1_WACR0_ADDR A:0x79b12a0
y.create.l HWIO_QPIC_QPIC_MPU_XPU_PRT2_WACR0_ADDR A:0x79b1320
y.create.l HWIO_QPIC_QPIC_MPU_XPU_PRT3_WACR0_ADDR A:0x79b13a0
y.create.l HWIO_QPIC_QPIC_MPU_XPU_PRT4_WACR0_ADDR A:0x79b1420
y.create.l HWIO_QPIC_QPIC_MPU_XPU_PRT5_WACR0_ADDR A:0x79b14a0
y.create.l HWIO_QPIC_QPIC_MPU_XPU_PRT6_WACR0_ADDR A:0x79b1520
y.create.l HWIO_QPIC_QPIC_MPU_XPU_PRT7_WACR0_ADDR A:0x79b15a0
y.create.l HWIO_QPIC_QPIC_MPU_XPU_PRT0_START0_ADDR A:0x79b1240
y.create.l HWIO_QPIC_QPIC_MPU_XPU_PRT1_START0_ADDR A:0x79b12c0
y.create.l HWIO_QPIC_QPIC_MPU_XPU_PRT2_START0_ADDR A:0x79b1340
y.create.l HWIO_QPIC_QPIC_MPU_XPU_PRT3_START0_ADDR A:0x79b13c0
y.create.l HWIO_QPIC_QPIC_MPU_XPU_PRT4_START0_ADDR A:0x79b1440
y.create.l HWIO_QPIC_QPIC_MPU_XPU_PRT5_START0_ADDR A:0x79b14c0
y.create.l HWIO_QPIC_QPIC_MPU_XPU_PRT6_START0_ADDR A:0x79b1540
y.create.l HWIO_QPIC_QPIC_MPU_XPU_PRT7_START0_ADDR A:0x79b15c0
y.create.l HWIO_QPIC_QPIC_MPU_XPU_PRT0_START1_ADDR A:0x79b1244
y.create.l HWIO_QPIC_QPIC_MPU_XPU_PRT1_START1_ADDR A:0x79b12c4
y.create.l HWIO_QPIC_QPIC_MPU_XPU_PRT2_START1_ADDR A:0x79b1344
y.create.l HWIO_QPIC_QPIC_MPU_XPU_PRT3_START1_ADDR A:0x79b13c4
y.create.l HWIO_QPIC_QPIC_MPU_XPU_PRT4_START1_ADDR A:0x79b1444
y.create.l HWIO_QPIC_QPIC_MPU_XPU_PRT5_START1_ADDR A:0x79b14c4
y.create.l HWIO_QPIC_QPIC_MPU_XPU_PRT6_START1_ADDR A:0x79b1544
y.create.l HWIO_QPIC_QPIC_MPU_XPU_PRT7_START1_ADDR A:0x79b15c4
y.create.l HWIO_QPIC_QPIC_MPU_XPU_PRT0_END0_ADDR A:0x79b1248
y.create.l HWIO_QPIC_QPIC_MPU_XPU_PRT1_END0_ADDR A:0x79b12c8
y.create.l HWIO_QPIC_QPIC_MPU_XPU_PRT2_END0_ADDR A:0x79b1348
y.create.l HWIO_QPIC_QPIC_MPU_XPU_PRT3_END0_ADDR A:0x79b13c8
y.create.l HWIO_QPIC_QPIC_MPU_XPU_PRT4_END0_ADDR A:0x79b1448
y.create.l HWIO_QPIC_QPIC_MPU_XPU_PRT5_END0_ADDR A:0x79b14c8
y.create.l HWIO_QPIC_QPIC_MPU_XPU_PRT6_END0_ADDR A:0x79b1548
y.create.l HWIO_QPIC_QPIC_MPU_XPU_PRT7_END0_ADDR A:0x79b15c8
y.create.l HWIO_QPIC_QPIC_MPU_XPU_PRT0_END1_ADDR A:0x79b124c
y.create.l HWIO_QPIC_QPIC_MPU_XPU_PRT1_END1_ADDR A:0x79b12cc
y.create.l HWIO_QPIC_QPIC_MPU_XPU_PRT2_END1_ADDR A:0x79b134c
y.create.l HWIO_QPIC_QPIC_MPU_XPU_PRT3_END1_ADDR A:0x79b13cc
y.create.l HWIO_QPIC_QPIC_MPU_XPU_PRT4_END1_ADDR A:0x79b144c
y.create.l HWIO_QPIC_QPIC_MPU_XPU_PRT5_END1_ADDR A:0x79b14cc
y.create.l HWIO_QPIC_QPIC_MPU_XPU_PRT6_END1_ADDR A:0x79b154c
y.create.l HWIO_QPIC_QPIC_MPU_XPU_PRT7_END1_ADDR A:0x79b15cc
y.create.l HWIO_QPIC_QPIC_MPU_XPU_PRT0_SCR_ADDR A:0x79b1250
y.create.l HWIO_QPIC_QPIC_MPU_XPU_PRT1_SCR_ADDR A:0x79b12d0
y.create.l HWIO_QPIC_QPIC_MPU_XPU_PRT2_SCR_ADDR A:0x79b1350
y.create.l HWIO_QPIC_QPIC_MPU_XPU_PRT3_SCR_ADDR A:0x79b13d0
y.create.l HWIO_QPIC_QPIC_MPU_XPU_PRT4_SCR_ADDR A:0x79b1450
y.create.l HWIO_QPIC_QPIC_MPU_XPU_PRT5_SCR_ADDR A:0x79b14d0
y.create.l HWIO_QPIC_QPIC_MPU_XPU_PRT6_SCR_ADDR A:0x79b1550
y.create.l HWIO_QPIC_QPIC_MPU_XPU_PRT7_SCR_ADDR A:0x79b15d0
y.create.l HWIO_QPIC_QPIC_MPU_XPU_PRT0_MCR_ADDR A:0x79b1254
y.create.l HWIO_QPIC_QPIC_MPU_XPU_PRT1_MCR_ADDR A:0x79b12d4
y.create.l HWIO_QPIC_QPIC_MPU_XPU_PRT2_MCR_ADDR A:0x79b1354
y.create.l HWIO_QPIC_QPIC_MPU_XPU_PRT3_MCR_ADDR A:0x79b13d4
y.create.l HWIO_QPIC_QPIC_MPU_XPU_PRT4_MCR_ADDR A:0x79b1454
y.create.l HWIO_QPIC_QPIC_MPU_XPU_PRT5_MCR_ADDR A:0x79b14d4
y.create.l HWIO_QPIC_QPIC_MPU_XPU_PRT6_MCR_ADDR A:0x79b1554
y.create.l HWIO_QPIC_QPIC_MPU_XPU_PRT7_MCR_ADDR A:0x79b15d4
y.create.l HWIO_QPIC_QPIC_MPU_XPU_PRT0_CNTL0_ADDR A:0x79b1258
y.create.l HWIO_QPIC_QPIC_MPU_XPU_PRT1_CNTL0_ADDR A:0x79b12d8
y.create.l HWIO_QPIC_QPIC_MPU_XPU_PRT2_CNTL0_ADDR A:0x79b1358
y.create.l HWIO_QPIC_QPIC_MPU_XPU_PRT3_CNTL0_ADDR A:0x79b13d8
y.create.l HWIO_QPIC_QPIC_MPU_XPU_PRT4_CNTL0_ADDR A:0x79b1458
y.create.l HWIO_QPIC_QPIC_MPU_XPU_PRT5_CNTL0_ADDR A:0x79b14d8
y.create.l HWIO_QPIC_QPIC_MPU_XPU_PRT6_CNTL0_ADDR A:0x79b1558
y.create.l HWIO_QPIC_QPIC_MPU_XPU_PRT7_CNTL0_ADDR A:0x79b15d8
y.create.l HWIO_QPIC_QPIC_MPU_XPU_PRT0_CNTL1_ADDR A:0x79b125c
y.create.l HWIO_QPIC_QPIC_MPU_XPU_PRT1_CNTL1_ADDR A:0x79b12dc
y.create.l HWIO_QPIC_QPIC_MPU_XPU_PRT2_CNTL1_ADDR A:0x79b135c
y.create.l HWIO_QPIC_QPIC_MPU_XPU_PRT3_CNTL1_ADDR A:0x79b13dc
y.create.l HWIO_QPIC_QPIC_MPU_XPU_PRT4_CNTL1_ADDR A:0x79b145c
y.create.l HWIO_QPIC_QPIC_MPU_XPU_PRT5_CNTL1_ADDR A:0x79b14dc
y.create.l HWIO_QPIC_QPIC_MPU_XPU_PRT6_CNTL1_ADDR A:0x79b155c
y.create.l HWIO_QPIC_QPIC_MPU_XPU_PRT7_CNTL1_ADDR A:0x79b15dc
y.create.l HWIO_RBCPR_VERSION_ADDR A:0x48000
y.create.l HWIO_RBCPR_SENSOR_MASK0_ADDR A:0x48020
y.create.l HWIO_RBCPR_SENSOR_MASK1_ADDR A:0x48024
y.create.l HWIO_RBCPR_SENSOR_MASK2_ADDR A:0x48028
y.create.l HWIO_RBCPR_SENSOR_MASK3_ADDR A:0x4802c
y.create.l HWIO_RBCPR_SENSOR_BYPASS0_ADDR A:0x48030
y.create.l HWIO_RBCPR_SENSOR_BYPASS1_ADDR A:0x48034
y.create.l HWIO_RBCPR_SENSOR_BYPASS2_ADDR A:0x48038
y.create.l HWIO_RBCPR_SENSOR_BYPASS3_ADDR A:0x4803c
y.create.l HWIO_RBIF_PMIC_ADDR_ADDR A:0x48040
y.create.l HWIO_RBCPR_TIMER_INTERVAL_ADDR A:0x48044
y.create.l HWIO_RBIF_LIMIT_ADDR A:0x48048
y.create.l HWIO_RBIF_TIMER_ADJUST_ADDR A:0x4804c
y.create.l HWIO_RBCPR_GCNT_TARGET0_ADDR A:0x48060
y.create.l HWIO_RBCPR_GCNT_TARGET1_ADDR A:0x48064
y.create.l HWIO_RBCPR_GCNT_TARGET2_ADDR A:0x48068
y.create.l HWIO_RBCPR_GCNT_TARGET3_ADDR A:0x4806c
y.create.l HWIO_RBCPR_GCNT_TARGET4_ADDR A:0x48070
y.create.l HWIO_RBCPR_GCNT_TARGET5_ADDR A:0x48074
y.create.l HWIO_RBCPR_GCNT_TARGET6_ADDR A:0x48078
y.create.l HWIO_RBCPR_GCNT_TARGET7_ADDR A:0x4807c
y.create.l HWIO_RBCPR_STEP_QUOT_ADDR A:0x48080
y.create.l HWIO_RBCPR_CTL_ADDR A:0x48090
y.create.l HWIO_RBIF_SW_VLEVEL_ADDR A:0x48094
y.create.l HWIO_RBIF_CONT_ACK_CMD_ADDR A:0x48098
y.create.l HWIO_RBIF_CONT_NACK_CMD_ADDR A:0x4809c
y.create.l HWIO_RBCPR_RESULT_0_ADDR A:0x480a0
y.create.l HWIO_RBCPR_RESULT_1_ADDR A:0x480a4
y.create.l HWIO_RBIF_IRQ_EN_0_ADDR A:0x48100
y.create.l HWIO_RBIF_IRQ_EN_1_ADDR A:0x48104
y.create.l HWIO_RBIF_IRQ_EN_2_ADDR A:0x48108
y.create.l HWIO_RBIF_IRQ_CLEAR_ADDR A:0x48110
y.create.l HWIO_RBIF_IRQ_STATUS_ADDR A:0x48114
y.create.l HWIO_RBCPR_QUOT_AVG_ADDR A:0x48118
y.create.l HWIO_RBCPR_DEBUG0_ADDR A:0x4811c
y.create.l HWIO_RBCPR_DEBUG1_ADDR A:0x48120
y.create.l HWIO_RBCPR_DEBUG2_ADDR A:0x48124
y.create.l HWIO_RBCPR_BIST_MINMAX_ADDR A:0x48128
y.create.l HWIO_RBCPR_BIST_RESULT_ADDR A:0x4812c
y.create.l HWIO_RBCPR_BIST_FAIL_MAP0_ADDR A:0x48130
y.create.l HWIO_RBCPR_BIST_FAIL_MAP1_ADDR A:0x48134
y.create.l HWIO_RBCPR_BIST_FAIL_MAP2_ADDR A:0x48138
y.create.l HWIO_RBCPR_BIST_FAIL_MAP3_ADDR A:0x4813c
y.create.l HWIO_RBCPR_LOG_0_ADDR A:0x48140
y.create.l HWIO_RBCPR_LOG_1_ADDR A:0x48144
y.create.l HWIO_RBCPR_LOG_2_ADDR A:0x48148
y.create.l HWIO_RBCPR_LOG_3_ADDR A:0x4814c
y.create.l HWIO_RBCPR_LOG_4_ADDR A:0x48150
y.create.l HWIO_RBCPR_LOG_5_ADDR A:0x48154
y.create.l HWIO_RBCPR_LOG_6_ADDR A:0x48158
y.create.l HWIO_RBCPR_LOG_7_ADDR A:0x4815c
y.create.l HWIO_RBCPR_HTOL_AGE_ADDR A:0x48160
y.create.l HWIO_RPM_HW_VERSION_ADDR A:0x280000
y.create.l HWIO_RPM_WFI_CONFIG_ADDR A:0x280004
y.create.l HWIO_RPM_TIMERS_CLK_OFF_CTL_ADDR A:0x280008
y.create.l HWIO_RPM_IPC_ADDR A:0x28000c
y.create.l HWIO_RPM_GPO_WDATA_ADDR A:0x280010
y.create.l HWIO_RPM_GPO_WDSET_ADDR A:0x280014
y.create.l HWIO_RPM_GPO_WDCLR_ADDR A:0x280018
y.create.l HWIO_RPM_SLAVES_CLK_GATING_ADDR A:0x28001c
y.create.l HWIO_RPM_INTR_POLARITY_0_ADDR A:0x280030
y.create.l HWIO_RPM_INTR_POLARITY_1_ADDR A:0x280034
y.create.l HWIO_RPM_INTR_EDG_LVL_0_ADDR A:0x280038
y.create.l HWIO_RPM_INTR_EDG_LVL_1_ADDR A:0x28003c
y.create.l HWIO_RPM_WDOG_RESET_ADDR A:0x280040
y.create.l HWIO_RPM_WDOG_CTRL_ADDR A:0x280044
y.create.l HWIO_RPM_WDOG_STATUS_ADDR A:0x280048
y.create.l HWIO_RPM_WDOG_BARK_TIME_ADDR A:0x28004c
y.create.l HWIO_RPM_WDOG_BITE_TIME_ADDR A:0x280050
y.create.l HWIO_RPM_WDOG_TEST_LOAD_ADDR A:0x280054
y.create.l HWIO_RPM_WDOG_TEST_ADDR A:0x280058
y.create.l HWIO_RPM_TEST_BUS_SEL_ADDR A:0x28005c
y.create.l HWIO_RPM_SPARE_REG0_ADDR A:0x280060
y.create.l HWIO_RPM_SPARE_REG1_ADDR A:0x280064
y.create.l HWIO_RPM_SPARE_REG2_ADDR A:0x280068
y.create.l HWIO_RPM_SPARE_REG3_ADDR A:0x28006c
y.create.l HWIO_RPM_PAGE_SELECT_ADDR A:0x280070
y.create.l HWIO_RPM_QTMR_AC_CNTFRQ_ADDR A:0x282000
y.create.l HWIO_RPM_QTMR_AC_CNTSR_ADDR A:0x282004
y.create.l HWIO_RPM_QTMR_AC_CNTTID_ADDR A:0x282008
y.create.l HWIO_RPM_QTMR_AC_CNTACR_0_ADDR A:0x282040
y.create.l HWIO_RPM_QTMR_AC_CNTACR_1_ADDR A:0x282044
y.create.l HWIO_RPM_QTMR_AC_CNTVOFF_LO_0_ADDR A:0x282080
y.create.l HWIO_RPM_QTMR_AC_CNTVOFF_LO_1_ADDR A:0x282088
y.create.l HWIO_RPM_QTMR_AC_CNTVOFF_HI_0_ADDR A:0x282084
y.create.l HWIO_RPM_QTMR_AC_CNTVOFF_HI_1_ADDR A:0x28208c
y.create.l HWIO_RPM_QTMR_AC_CFG_ADDR A:0x282fc0
y.create.l HWIO_RPM_QTMR_AC_VERSION_ADDR A:0x282fd0
y.create.l HWIO_RPM_F0_QTMR_V1_CNTPCT_LO_ADDR A:0x283000
y.create.l HWIO_RPM_F0_QTMR_V1_CNTPCT_HI_ADDR A:0x283004
y.create.l HWIO_RPM_F0_QTMR_V1_CNTVCT_LO_ADDR A:0x283008
y.create.l HWIO_RPM_F0_QTMR_V1_CNTVCT_HI_ADDR A:0x28300c
y.create.l HWIO_RPM_F0_QTMR_V1_CNTFRQ_ADDR A:0x283010
y.create.l HWIO_RPM_F0_QTMR_V1_CNTPL0ACR_ADDR A:0x283014
y.create.l HWIO_RPM_F0_QTMR_V1_CNTVOFF_LO_ADDR A:0x283018
y.create.l HWIO_RPM_F0_QTMR_V1_CNTVOFF_HI_ADDR A:0x28301c
y.create.l HWIO_RPM_F0_QTMR_V1_CNTP_CVAL_LO_ADDR A:0x283020
y.create.l HWIO_RPM_F0_QTMR_V1_CNTP_CVAL_HI_ADDR A:0x283024
y.create.l HWIO_RPM_F0_QTMR_V1_CNTP_TVAL_ADDR A:0x283028
y.create.l HWIO_RPM_F0_QTMR_V1_CNTP_CTL_ADDR A:0x28302c
y.create.l HWIO_RPM_F0_QTMR_V1_CNTV_CVAL_LO_ADDR A:0x283030
y.create.l HWIO_RPM_F0_QTMR_V1_CNTV_CVAL_HI_ADDR A:0x283034
y.create.l HWIO_RPM_F0_QTMR_V1_CNTV_TVAL_ADDR A:0x283038
y.create.l HWIO_RPM_F0_QTMR_V1_CNTV_CTL_ADDR A:0x28303c
y.create.l HWIO_RPM_F0_QTMR_V1_VERSION_ADDR A:0x283fd0
y.create.l HWIO_RPM_F1_QTMR_V1_CNTPCT_LO_ADDR A:0x284000
y.create.l HWIO_RPM_F1_QTMR_V1_CNTPCT_HI_ADDR A:0x284004
y.create.l HWIO_RPM_F1_QTMR_V1_CNTVCT_LO_ADDR A:0x284008
y.create.l HWIO_RPM_F1_QTMR_V1_CNTVCT_HI_ADDR A:0x28400c
y.create.l HWIO_RPM_F1_QTMR_V1_CNTFRQ_ADDR A:0x284010
y.create.l HWIO_RPM_F1_QTMR_V1_CNTPL0ACR_ADDR A:0x284014
y.create.l HWIO_RPM_F1_QTMR_V1_CNTVOFF_LO_ADDR A:0x284018
y.create.l HWIO_RPM_F1_QTMR_V1_CNTVOFF_HI_ADDR A:0x28401c
y.create.l HWIO_RPM_F1_QTMR_V1_CNTP_CVAL_LO_ADDR A:0x284020
y.create.l HWIO_RPM_F1_QTMR_V1_CNTP_CVAL_HI_ADDR A:0x284024
y.create.l HWIO_RPM_F1_QTMR_V1_CNTP_TVAL_ADDR A:0x284028
y.create.l HWIO_RPM_F1_QTMR_V1_CNTP_CTL_ADDR A:0x28402c
y.create.l HWIO_RPM_F1_QTMR_V1_CNTV_CVAL_LO_ADDR A:0x284030
y.create.l HWIO_RPM_F1_QTMR_V1_CNTV_CVAL_HI_ADDR A:0x284034
y.create.l HWIO_RPM_F1_QTMR_V1_CNTV_TVAL_ADDR A:0x284038
y.create.l HWIO_RPM_F1_QTMR_V1_CNTV_CTL_ADDR A:0x28403c
y.create.l HWIO_RPM_F1_QTMR_V1_VERSION_ADDR A:0x284fd0
y.create.l HWIO_RPM_APU_XPU_SCR_ADDR A:0x287000
y.create.l HWIO_RPM_APU_XPU_SWDR_ADDR A:0x287004
y.create.l HWIO_RPM_APU_XPU_SEAR0_ADDR A:0x287040
y.create.l HWIO_RPM_APU_XPU_SESR_ADDR A:0x287048
y.create.l HWIO_RPM_APU_XPU_SESRRESTORE_ADDR A:0x28704c
y.create.l HWIO_RPM_APU_XPU_SESYNR0_ADDR A:0x287050
y.create.l HWIO_RPM_APU_XPU_SESYNR1_ADDR A:0x287054
y.create.l HWIO_RPM_APU_XPU_SESYNR2_ADDR A:0x287058
y.create.l HWIO_RPM_APU_XPU_MCR_ADDR A:0x287100
y.create.l HWIO_RPM_APU_XPU_MEAR0_ADDR A:0x287140
y.create.l HWIO_RPM_APU_XPU_MESR_ADDR A:0x287148
y.create.l HWIO_RPM_APU_XPU_MESRRESTORE_ADDR A:0x28714c
y.create.l HWIO_RPM_APU_XPU_MESYNR0_ADDR A:0x287150
y.create.l HWIO_RPM_APU_XPU_MESYNR1_ADDR A:0x287154
y.create.l HWIO_RPM_APU_XPU_MESYNR2_ADDR A:0x287158
y.create.l HWIO_RPM_APU_XPU_CR_ADDR A:0x287080
y.create.l HWIO_RPM_APU_XPU_RPU_ACR0_ADDR A:0x2870a0
y.create.l HWIO_RPM_APU_XPU_EAR0_ADDR A:0x2870c0
y.create.l HWIO_RPM_APU_XPU_ESR_ADDR A:0x2870c8
y.create.l HWIO_RPM_APU_XPU_ESRRESTORE_ADDR A:0x2870cc
y.create.l HWIO_RPM_APU_XPU_ESYNR0_ADDR A:0x2870d0
y.create.l HWIO_RPM_APU_XPU_ESYNR1_ADDR A:0x2870d4
y.create.l HWIO_RPM_APU_XPU_ESYNR2_ADDR A:0x2870d8
y.create.l HWIO_RPM_APU_XPU_IDR0_ADDR A:0x287074
y.create.l HWIO_RPM_APU_XPU_IDR1_ADDR A:0x287078
y.create.l HWIO_RPM_APU_XPU_REV_ADDR A:0x28707c
y.create.l HWIO_RPM_APU_XPU_RG0_RACR0_ADDR A:0x287200
y.create.l HWIO_RPM_APU_XPU_RG1_RACR0_ADDR A:0x287280
y.create.l HWIO_RPM_APU_XPU_RG0_WACR0_ADDR A:0x287220
y.create.l HWIO_RPM_APU_XPU_RG1_WACR0_ADDR A:0x2872a0
y.create.l HWIO_RPM_APU_XPU_RG0_SCR_ADDR A:0x287250
y.create.l HWIO_RPM_APU_XPU_RG1_SCR_ADDR A:0x2872d0
y.create.l HWIO_RPM_APU_XPU_RG0_MCR_ADDR A:0x287254
y.create.l HWIO_RPM_APU_XPU_RG1_MCR_ADDR A:0x2872d4
y.create.l HWIO_RPM_VMIDMT_SCR0_ADDR A:0x288000
y.create.l HWIO_RPM_VMIDMT_SCR1_ADDR A:0x288004
y.create.l HWIO_RPM_VMIDMT_SCR2_ADDR A:0x288008
y.create.l HWIO_RPM_VMIDMT_SACR_ADDR A:0x288010
y.create.l HWIO_RPM_VMIDMT_SIDR0_ADDR A:0x288020
y.create.l HWIO_RPM_VMIDMT_SIDR1_ADDR A:0x288024
y.create.l HWIO_RPM_VMIDMT_SIDR2_ADDR A:0x288028
y.create.l HWIO_RPM_VMIDMT_SIDR4_ADDR A:0x288030
y.create.l HWIO_RPM_VMIDMT_SIDR5_ADDR A:0x288034
y.create.l HWIO_RPM_VMIDMT_SIDR7_ADDR A:0x28803c
y.create.l HWIO_RPM_VMIDMT_SGFAR0_ADDR A:0x288040
y.create.l HWIO_RPM_VMIDMT_SGFSR_ADDR A:0x288048
y.create.l HWIO_RPM_VMIDMT_SGFSRRESTORE_ADDR A:0x28804c
y.create.l HWIO_RPM_VMIDMT_SGFSYNDR0_ADDR A:0x288050
y.create.l HWIO_RPM_VMIDMT_SGFSYNDR1_ADDR A:0x288054
y.create.l HWIO_RPM_VMIDMT_SGFSYNDR2_ADDR A:0x288058
y.create.l HWIO_RPM_VMIDMT_VMIDMTSCR0_ADDR A:0x288090
y.create.l HWIO_RPM_VMIDMT_CR0_ADDR A:0x288000
y.create.l HWIO_RPM_VMIDMT_CR2_ADDR A:0x288008
y.create.l HWIO_RPM_VMIDMT_ACR_ADDR A:0x288010
y.create.l HWIO_RPM_VMIDMT_IDR0_ADDR A:0x288020
y.create.l HWIO_RPM_VMIDMT_IDR1_ADDR A:0x288024
y.create.l HWIO_RPM_VMIDMT_IDR2_ADDR A:0x288028
y.create.l HWIO_RPM_VMIDMT_IDR4_ADDR A:0x288030
y.create.l HWIO_RPM_VMIDMT_IDR5_ADDR A:0x288034
y.create.l HWIO_RPM_VMIDMT_IDR7_ADDR A:0x28803c
y.create.l HWIO_RPM_VMIDMT_GFAR0_ADDR A:0x288040
y.create.l HWIO_RPM_VMIDMT_GFSR_ADDR A:0x288048
y.create.l HWIO_RPM_VMIDMT_GFSRRESTORE_ADDR A:0x28804c
y.create.l HWIO_RPM_VMIDMT_GFSYNDR0_ADDR A:0x288050
y.create.l HWIO_RPM_VMIDMT_GFSYNDR1_ADDR A:0x288054
y.create.l HWIO_RPM_VMIDMT_GFSYNDR2_ADDR A:0x288058
y.create.l HWIO_RPM_VMIDMT_VMIDMTCR0_ADDR A:0x288090
y.create.l HWIO_RPM_VMIDMT_VMIDMTACR_ADDR A:0x28809c
y.create.l HWIO_RPM_VMIDMT_NSCR0_ADDR A:0x288400
y.create.l HWIO_RPM_VMIDMT_NSCR2_ADDR A:0x288408
y.create.l HWIO_RPM_VMIDMT_NSACR_ADDR A:0x288410
y.create.l HWIO_RPM_VMIDMT_NSGFAR0_ADDR A:0x288440
y.create.l HWIO_RPM_VMIDMT_NSGFSR_ADDR A:0x288448
y.create.l HWIO_RPM_VMIDMT_NSGFSRRESTORE_ADDR A:0x28844c
y.create.l HWIO_RPM_VMIDMT_NSGFSYNDR0_ADDR A:0x288450
y.create.l HWIO_RPM_VMIDMT_NSGFSYNDR1_ADDR A:0x288454
y.create.l HWIO_RPM_VMIDMT_NSGFSYNDR2_ADDR A:0x288458
y.create.l HWIO_RPM_VMIDMT_NSVMIDMTCR0_ADDR A:0x288490
y.create.l HWIO_RPM_VMIDMT_SSDR0_ADDR A:0x288080
y.create.l HWIO_RPM_VMIDMT_MSDR0_ADDR A:0x288480
y.create.l HWIO_RPM_VMIDMT_MCR_ADDR A:0x288494
y.create.l HWIO_RPM_VMIDMT_S2VR0_ADDR A:0x288c00
y.create.l HWIO_RPM_VMIDMT_AS2VR0_ADDR A:0x288e00
y.create.l HWIO_SDC1_SDCC_MCI_POWER_ADDR A:0x7824000
y.create.l HWIO_SDC1_SDCC_MCI_CLK_ADDR A:0x7824004
y.create.l HWIO_SDC1_SDCC_MCI_ARGUMENT_ADDR A:0x7824008
y.create.l HWIO_SDC1_SDCC_MCI_CMD_ADDR A:0x782400c
y.create.l HWIO_SDC1_SDCC_MCI_RESP_CMD_ADDR A:0x7824010
y.create.l HWIO_SDC1_SDCC_MCI_RESP0_ADDR A:0x7824014
y.create.l HWIO_SDC1_SDCC_MCI_RESP1_ADDR A:0x7824018
y.create.l HWIO_SDC1_SDCC_MCI_RESP2_ADDR A:0x782401c
y.create.l HWIO_SDC1_SDCC_MCI_RESP3_ADDR A:0x7824020
y.create.l HWIO_SDC1_SDCC_MCI_DATA_TIMER_ADDR A:0x7824024
y.create.l HWIO_SDC1_SDCC_MCI_DATA_LENGTH_ADDR A:0x7824028
y.create.l HWIO_SDC1_SDCC_MCI_DATA_CTL_ADDR A:0x782402c
y.create.l HWIO_SDC1_SDCC_MCI_DATA_COUNT_ADDR A:0x7824030
y.create.l HWIO_SDC1_SDCC_MCI_STATUS_ADDR A:0x7824034
y.create.l HWIO_SDC1_SDCC_MCI_CLEAR_ADDR A:0x7824038
y.create.l HWIO_SDC1_SDCC_MCI_INT_MASK0_ADDR A:0x782403c
y.create.l HWIO_SDC1_SDCC_MCI_INT_MASK1_ADDR A:0x7824040
y.create.l HWIO_SDC1_SDCC_MCI_FIFO_COUNT_ADDR A:0x7824044
y.create.l HWIO_SDC1_SDCC_MCI_BOOT_ADDR A:0x7824048
y.create.l HWIO_SDC1_SDCC_MCI_BOOT_ACK_TIMER_ADDR A:0x782404c
y.create.l HWIO_SDC1_SDCC_MCI_VERSION_ADDR A:0x7824050
y.create.l HWIO_SDC1_SDCC_MCI_EMULATION_DLY_LINE_ADDR A:0x7824054
y.create.l HWIO_SDC1_SDCC_MCI_CCS_TIMER_ADDR A:0x7824058
y.create.l HWIO_SDC1_SDCC_MCI_RESPONSE_MASK_ADDR A:0x782405c
y.create.l HWIO_SDC1_SDCC_MCI_DLL_CONFIG_ADDR A:0x7824060
y.create.l HWIO_SDC1_SDCC_MCI_DLL_TEST_CTL_ADDR A:0x7824064
y.create.l HWIO_SDC1_SDCC_MCI_DLL_STATUS_ADDR A:0x7824068
y.create.l HWIO_SDC1_SDCC_MCI_STATUS2_ADDR A:0x782406c
y.create.l HWIO_SDC1_SDCC_MCI_GENERICS_ADDR A:0x7824070
y.create.l HWIO_SDC1_SDCC_MCI_FIFO_STATUS_ADDR A:0x7824074
y.create.l HWIO_SDC1_SDCC_MCI_HC_MODE_ADDR A:0x7824078
y.create.l HWIO_SDC1_SDCC_MCI_FIFO0_ADDR A:0x7824080
y.create.l HWIO_SDC1_SDCC_MCI_FIFO1_ADDR A:0x7824084
y.create.l HWIO_SDC1_SDCC_MCI_FIFO2_ADDR A:0x7824088
y.create.l HWIO_SDC1_SDCC_MCI_FIFO3_ADDR A:0x782408c
y.create.l HWIO_SDC1_SDCC_MCI_FIFO4_ADDR A:0x7824090
y.create.l HWIO_SDC1_SDCC_MCI_FIFO5_ADDR A:0x7824094
y.create.l HWIO_SDC1_SDCC_MCI_FIFO6_ADDR A:0x7824098
y.create.l HWIO_SDC1_SDCC_MCI_FIFO7_ADDR A:0x782409c
y.create.l HWIO_SDC1_SDCC_MCI_FIFO8_ADDR A:0x78240a0
y.create.l HWIO_SDC1_SDCC_MCI_FIFO9_ADDR A:0x78240a4
y.create.l HWIO_SDC1_SDCC_MCI_TESTBUS_CONFIG_ADDR A:0x78240cc
y.create.l HWIO_SDC1_SDCC_MCI_TEST_CTL_ADDR A:0x78240d0
y.create.l HWIO_SDC1_SDCC_MCI_TEST_INPUT_ADDR A:0x78240d4
y.create.l HWIO_SDC1_SDCC_MCI_TEST_OUT_ADDR A:0x78240d8
y.create.l HWIO_SDC1_SDCC_MCI_PWRCTL_STATUS_REG_ADDR A:0x78240dc
y.create.l HWIO_SDC1_SDCC_MCI_PWRCTL_MASK_REG_ADDR A:0x78240e0
y.create.l HWIO_SDC1_SDCC_MCI_PWRCTL_CLEAR_REG_ADDR A:0x78240e4
y.create.l HWIO_SDC1_SDCC_MCI_PWRCTL_CTL_REG_ADDR A:0x78240e8
y.create.l HWIO_SDC1_SDCC_MCI_CLEAR2_ADDR A:0x78240ec
y.create.l HWIO_SDC1_SDCC_MCI_INT_MASKINT2_0_ADDR A:0x78240f0
y.create.l HWIO_SDC1_SDCC_MCI_INT_MASKINT2_1_ADDR A:0x78240f4
y.create.l HWIO_SDC1_SDCC_CHAR_CFG_ADDR A:0x78240fc
y.create.l HWIO_SDC1_SDCC_CHAR_CMD_ADDR A:0x7824100
y.create.l HWIO_SDC1_SDCC_CHAR_DATA_0_ADDR A:0x7824104
y.create.l HWIO_SDC1_SDCC_CHAR_DATA_1_ADDR A:0x7824108
y.create.l HWIO_SDC1_SDCC_CHAR_DATA_2_ADDR A:0x782410c
y.create.l HWIO_SDC1_SDCC_CHAR_DATA_3_ADDR A:0x7824110
y.create.l HWIO_SDC1_SDCC_CHAR_DATA_4_ADDR A:0x7824114
y.create.l HWIO_SDC1_SDCC_CHAR_DATA_5_ADDR A:0x7824118
y.create.l HWIO_SDC1_SDCC_CHAR_DATA_6_ADDR A:0x782411c
y.create.l HWIO_SDC1_SDCC_CHAR_DATA_7_ADDR A:0x7824120
y.create.l HWIO_SDC1_SDCC_DEBUG_REG_ADDR A:0x7824124
y.create.l HWIO_SDC1_SDCC_IP_CATALOG_ADDR A:0x7824128
y.create.l HWIO_SDC1_SDCC_QSB_VALUES_ADDR A:0x782412c
y.create.l HWIO_SDC1_SDCC_QSB_AXI_VALUES_ADDR A:0x7824130
y.create.l HWIO_SDC1_SDCC_AXI_DATA_ERR_DBUG_ADDR A:0x7824134
y.create.l HWIO_SDC1_SDCC_T4_DLY_CTRL_ADDR A:0x7824138
y.create.l HWIO_SDC1_SDCC_T4_DLY_STAT_ADDR A:0x782413c
y.create.l HWIO_SDC1_SDCC_CSR_CDC_CTLR_CFG0_ADDR A:0x7824140
y.create.l HWIO_SDC1_SDCC_CSR_CDC_CTLR_CFG1_ADDR A:0x7824144
y.create.l HWIO_SDC1_SDCC_CSR_CDC_CAL_TIMER_CFG0_ADDR A:0x7824148
y.create.l HWIO_SDC1_SDCC_CSR_CDC_CAL_TIMER_CFG1_ADDR A:0x782414c
y.create.l HWIO_SDC1_SDCC_CSR_CDC_REFCOUNT_CFG_ADDR A:0x7824150
y.create.l HWIO_SDC1_SDCC_CSR_CDC_COARSE_CAL_CFG_ADDR A:0x7824154
y.create.l HWIO_SDC1_SDCC_CSR_CDC_RSVD_CFG_ADDR A:0x7824158
y.create.l HWIO_SDC1_SDCC_CSR_CDC_OFFSET_CFG_ADDR A:0x782415c
y.create.l HWIO_SDC1_SDCC_CSR_CDC_DELAY_CFG_ADDR A:0x7824160
y.create.l HWIO_SDC1_SDCC_CSR_CDC_SW_MODE_CFG_ADDR A:0x7824164
y.create.l HWIO_SDC1_SDCC_CSR_CDC_TEST_CFG_ADDR A:0x7824168
y.create.l HWIO_SDC1_SDCC_CSR_CDC_SW_OVRD_CFG_ADDR A:0x782416c
y.create.l HWIO_SDC1_SDCC_CSR_CDC_SLAVE_DDA_CFG_ADDR A:0x7824170
y.create.l HWIO_SDC1_SDCC_CSR_CDC_STATUS0_ADDR A:0x7824174
y.create.l HWIO_SDC1_SDCC_CSR_CDC_STATUS1_ADDR A:0x7824178
y.create.l HWIO_SDC1_SDCC_CSR_CDC_STATUS2_ADDR A:0x782417c
y.create.l HWIO_SDC1_SDCC_CSR_CDC_STATUS3_ADDR A:0x7824180
y.create.l HWIO_SDC1_SDCC_CSR_CDC_STATUS4_ADDR A:0x7824184
y.create.l HWIO_SDC1_SDCC_CSR_CDC_GEN_CFG_ADDR A:0x7824188
y.create.l HWIO_SDC1_SDCC_CDC_AUTO_SW_CAL_CFG_ADDR A:0x782418c
y.create.l HWIO_SDC1_SDCC_DDR200_STAT_ADDR A:0x7824190
y.create.l HWIO_SDC1_SDCC_DDR200_CFG_ADDR A:0x7824194
y.create.l HWIO_SDC1_SDCC_TIME_COUNT_CTRL_ADDR A:0x7824198
y.create.l HWIO_SDC1_SDCC_FLOW_CTRL_TIME_COUNT_ADDR A:0x782419c
y.create.l HWIO_SDC1_SDCC_BUSY_TIME_COUNT_ADDR A:0x78241a0
y.create.l HWIO_SDC1_SDCC_DATA_TIME_COUNT_ADDR A:0x78241a4
y.create.l HWIO_SDC1_SDCC_CMD_TIME_COUNT_ADDR A:0x78241a8
y.create.l HWIO_SDC1_SDCC_MCI_DLL_CONFIG_2_ADDR A:0x78241ac
y.create.l HWIO_SDC1_SDCC_MCI_DDR_CONFIG_ADDR A:0x78241b0
y.create.l HWIO_SDC1_SDCC_MCI_FIFO_ALT0_ADDR A:0x7824400
y.create.l HWIO_SDC1_SDCC_MCI_FIFO_ALT1_ADDR A:0x7824404
y.create.l HWIO_SDC1_SDCC_MCI_FIFO_ALT2_ADDR A:0x7824408
y.create.l HWIO_SDC1_SDCC_MCI_FIFO_ALT3_ADDR A:0x782440c
y.create.l HWIO_SDC1_SDCC_MCI_FIFO_ALT4_ADDR A:0x7824410
y.create.l HWIO_SDC1_SDCC_MCI_FIFO_ALT5_ADDR A:0x7824414
y.create.l HWIO_SDC1_SDCC_MCI_FIFO_ALT6_ADDR A:0x7824418
y.create.l HWIO_SDC1_SDCC_MCI_FIFO_ALT7_ADDR A:0x782441c
y.create.l HWIO_SDC1_SDCC_MCI_FIFO_ALT8_ADDR A:0x7824420
y.create.l HWIO_SDC1_SDCC_MCI_FIFO_ALT9_ADDR A:0x7824424
y.create.l HWIO_SDC1_SDCC_HC_REG_0_2_ADDR A:0x7824900
y.create.l HWIO_SDC1_SDCC_HC_REG_4_6_ADDR A:0x7824904
y.create.l HWIO_SDC1_SDCC_HC_REG_8_A_ADDR A:0x7824908
y.create.l HWIO_SDC1_SDCC_HC_REG_C_E_ADDR A:0x782490c
y.create.l HWIO_SDC1_SDCC_HC_REG_10_12_ADDR A:0x7824910
y.create.l HWIO_SDC1_SDCC_HC_REG_14_16_ADDR A:0x7824914
y.create.l HWIO_SDC1_SDCC_HC_REG_18_1A_ADDR A:0x7824918
y.create.l HWIO_SDC1_SDCC_HC_REG_1C_1E_ADDR A:0x782491c
y.create.l HWIO_SDC1_SDCC_HC_REG_20_22_ADDR A:0x7824920
y.create.l HWIO_SDC1_SDCC_HC_REG_24_26_ADDR A:0x7824924
y.create.l HWIO_SDC1_SDCC_HC_REG_28_2A_ADDR A:0x7824928
y.create.l HWIO_SDC1_SDCC_HC_REG_2C_2E_ADDR A:0x782492c
y.create.l HWIO_SDC1_SDCC_HC_REG_30_32_ADDR A:0x7824930
y.create.l HWIO_SDC1_SDCC_HC_REG_34_36_ADDR A:0x7824934
y.create.l HWIO_SDC1_SDCC_HC_REG_38_3A_ADDR A:0x7824938
y.create.l HWIO_SDC1_SDCC_HC_REG_3C_3E_ADDR A:0x782493c
y.create.l HWIO_SDC1_SDCC_HC_REG_40_42_ADDR A:0x7824940
y.create.l HWIO_SDC1_SDCC_HC_REG_44_46_ADDR A:0x7824944
y.create.l HWIO_SDC1_SDCC_HC_REG_48_4A_ADDR A:0x7824948
y.create.l HWIO_SDC1_SDCC_HC_REG_50_52_ADDR A:0x7824950
y.create.l HWIO_SDC1_SDCC_HC_REG_54_56_ADDR A:0x7824954
y.create.l HWIO_SDC1_SDCC_HC_REG_58_5A_ADDR A:0x7824958
y.create.l HWIO_SDC1_SDCC_HC_REG_5C_5E_ADDR A:0x782495c
y.create.l HWIO_SDC1_SDCC_HC_REG_60_62_ADDR A:0x7824960
y.create.l HWIO_SDC1_SDCC_HC_REG_64_66_ADDR A:0x7824964
y.create.l HWIO_SDC1_SDCC_HC_REG_68_6A_ADDR A:0x7824968
y.create.l HWIO_SDC1_SDCC_HC_REG_6C_6E_ADDR A:0x782496c
y.create.l HWIO_SDC1_SDCC_HC_REG_E0_E2_ADDR A:0x78249e0
y.create.l HWIO_SDC1_SDCC_HC_REG_FC_FE_ADDR A:0x78249fc
y.create.l HWIO_SDC1_SDCC_HC_REG_DLL_CONFIG_ADDR A:0x7824a00
y.create.l HWIO_SDC1_SDCC_HC_REG_DLL_TEST_CTL_ADDR A:0x7824a04
y.create.l HWIO_SDC1_SDCC_HC_REG_DLL_STATUS_ADDR A:0x7824a08
y.create.l HWIO_SDC1_SDCC_HC_VENDOR_SPECIFIC_FUNC_ADDR A:0x7824a0c
y.create.l HWIO_SDC1_SDCC_HC_VENDOR_SPECIFIC_FUNC2_ADDR A:0x7824a10
y.create.l HWIO_SDC1_SDCC_HC_VENDOR_SPECIFIC_ADMA_ERR_ADDR0_ADDR A:0x7824a14
y.create.l HWIO_SDC1_SDCC_HC_VENDOR_SPECIFIC_ADMA_ERR_ADDR1_ADDR A:0x7824a18
y.create.l HWIO_SDC1_SDCC_HC_VENDOR_SPECIFIC_CAPABILITIES0_ADDR A:0x7824a1c
y.create.l HWIO_SDC1_SDCC_HC_VENDOR_SPECIFIC_CAPABILITIES1_ADDR A:0x7824a20
y.create.l HWIO_SDC1_SDCC_HC_VENDOR_SPECIFIC_T4_DLY_CTRL_ADDR A:0x7824a24
y.create.l HWIO_SDC1_SDCC_HC_VENDOR_SPECIFIC_T4_DLY_STAT_ADDR A:0x7824a28
y.create.l HWIO_SDC1_SDCC_HC_VENDOR_SPECIFIC_CSR_CDC_CTLR_CFG0_ADDR A:0x7824a30
y.create.l HWIO_SDC1_SDCC_HC_VENDOR_SPECIFIC_CSR_CDC_CTLR_CFG1_ADDR A:0x7824a34
y.create.l HWIO_SDC1_SDCC_HC_VENDOR_SPECIFIC_CSR_CDC_CAL_TIMER_CFG0_ADDR A:0x7824a38
y.create.l HWIO_SDC1_SDCC_HC_VENDOR_SPECIFIC_CSR_CDC_CAL_TIMER_CFG1_ADDR A:0x7824a3c
y.create.l HWIO_SDC1_SDCC_HC_VENDOR_SPECIFIC_CSR_CDC_REFCOUNT_CFG_ADDR A:0x7824a40
y.create.l HWIO_SDC1_SDCC_HC_VENDOR_SPECIFIC_CSR_CDC_COARSE_CAL_CFG_ADDR A:0x7824a44
y.create.l HWIO_SDC1_SDCC_HC_VENDOR_SPECIFIC_CSR_CDC_RSVD_CFG_ADDR A:0x7824a48
y.create.l HWIO_SDC1_SDCC_HC_VENDOR_SPECIFIC_CSR_CDC_OFFSET_CFG_ADDR A:0x7824a4c
y.create.l HWIO_SDC1_SDCC_HC_VENDOR_SPECIFIC_CSR_CDC_DELAY_CFG_ADDR A:0x7824a50
y.create.l HWIO_SDC1_SDCC_HC_VENDOR_SPECIFIC_CSR_CDC_SW_MODE_CFG_ADDR A:0x7824a54
y.create.l HWIO_SDC1_SDCC_HC_VENDOR_SPECIFIC_CSR_CDC_TEST_CFG_ADDR A:0x7824a58
y.create.l HWIO_SDC1_SDCC_HC_VENDOR_SPECIFIC_CSR_CDC_SW_OVRD_CFG_ADDR A:0x7824a5c
y.create.l HWIO_SDC1_SDCC_HC_VENDOR_SPECIFIC_CSR_CDC_SLAVE_DDA_CFG_ADDR A:0x7824a60
y.create.l HWIO_SDC1_SDCC_HC_VENDOR_SPECIFIC_CSR_CDC_STATUS0_ADDR A:0x7824a64
y.create.l HWIO_SDC1_SDCC_HC_VENDOR_SPECIFIC_CSR_CDC_STATUS1_ADDR A:0x7824a68
y.create.l HWIO_SDC1_SDCC_HC_VENDOR_SPECIFIC_CSR_CDC_STATUS2_ADDR A:0x7824a6c
y.create.l HWIO_SDC1_SDCC_HC_VENDOR_SPECIFIC_CSR_CDC_STATUS3_ADDR A:0x7824a70
y.create.l HWIO_SDC1_SDCC_HC_VENDOR_SPECIFIC_CSR_CDC_STATUS4_ADDR A:0x7824a74
y.create.l HWIO_SDC1_SDCC_HC_VENDOR_SPECIFIC_CSR_CDC_GEN_CFG_ADDR A:0x7824a78
y.create.l HWIO_SDC1_SDCC_HC_VENDOR_SPECIFIC_CDC_AUTO_SW_CAL_CFG_ADDR A:0x7824a7c
y.create.l HWIO_SDC1_SDCC_HC_VENDOR_SPECIFIC_DDR200_STAT_ADDR A:0x7824a80
y.create.l HWIO_SDC1_SDCC_HC_VENDOR_SPECIFIC_DDR200_CFG_ADDR A:0x7824a84
y.create.l HWIO_SDC1_SDCC_HC_VENDOR_SPECIFIC_TIME_COUNT_CTRL_ADDR A:0x7824a88
y.create.l HWIO_SDC1_SDCC_HC_VENDOR_SPECIFIC_FLOW_CTRL_TIME_COUNT_ADDR A:0x7824a8c
y.create.l HWIO_SDC1_SDCC_HC_VENDOR_SPECIFIC_BUSY_TIME_COUNT_ADDR A:0x7824a90
y.create.l HWIO_SDC1_SDCC_HC_VENDOR_SPECIFIC_DATA_TIME_COUNT_ADDR A:0x7824a94
y.create.l HWIO_SDC1_SDCC_HC_VENDOR_SPECIFIC_CMD_TIME_COUNT_ADDR A:0x7824a98
y.create.l HWIO_SDC1_SDCC_HC_VENDOR_SPECIFIC_ERR_INT_STS_ADDR A:0x7824a9c
y.create.l HWIO_SDC1_SDCC_HC_VENDOR_SPECIFIC_PWRCTL_STATUS_REG_ADDR A:0x7824aa0
y.create.l HWIO_SDC1_SDCC_HC_VENDOR_SPECIFIC_PWRCTL_MASK_REG_ADDR A:0x7824aa4
y.create.l HWIO_SDC1_SDCC_HC_VENDOR_SPECIFIC_PWRCTL_CLEAR_REG_ADDR A:0x7824aa8
y.create.l HWIO_SDC1_SDCC_HC_VENDOR_SPECIFIC_PWRCTL_CTL_REG_ADDR A:0x7824aac
y.create.l HWIO_SDC1_SDCC_HC_VENDOR_SPECIFIC_FUNC3_ADDR A:0x7824ab0
y.create.l HWIO_SDC1_SDCC_HC_REG_DLL_CONFIG_2_ADDR A:0x7824ab4
y.create.l HWIO_SDC1_SDCC_HC_REG_DDR_CONFIG_ADDR A:0x7824ab8
y.create.l HWIO_SDC2_SDCC_MCI_POWER_ADDR A:0x7864000
y.create.l HWIO_SDC2_SDCC_MCI_CLK_ADDR A:0x7864004
y.create.l HWIO_SDC2_SDCC_MCI_ARGUMENT_ADDR A:0x7864008
y.create.l HWIO_SDC2_SDCC_MCI_CMD_ADDR A:0x786400c
y.create.l HWIO_SDC2_SDCC_MCI_RESP_CMD_ADDR A:0x7864010
y.create.l HWIO_SDC2_SDCC_MCI_RESP0_ADDR A:0x7864014
y.create.l HWIO_SDC2_SDCC_MCI_RESP1_ADDR A:0x7864018
y.create.l HWIO_SDC2_SDCC_MCI_RESP2_ADDR A:0x786401c
y.create.l HWIO_SDC2_SDCC_MCI_RESP3_ADDR A:0x7864020
y.create.l HWIO_SDC2_SDCC_MCI_DATA_TIMER_ADDR A:0x7864024
y.create.l HWIO_SDC2_SDCC_MCI_DATA_LENGTH_ADDR A:0x7864028
y.create.l HWIO_SDC2_SDCC_MCI_DATA_CTL_ADDR A:0x786402c
y.create.l HWIO_SDC2_SDCC_MCI_DATA_COUNT_ADDR A:0x7864030
y.create.l HWIO_SDC2_SDCC_MCI_STATUS_ADDR A:0x7864034
y.create.l HWIO_SDC2_SDCC_MCI_CLEAR_ADDR A:0x7864038
y.create.l HWIO_SDC2_SDCC_MCI_INT_MASK0_ADDR A:0x786403c
y.create.l HWIO_SDC2_SDCC_MCI_INT_MASK1_ADDR A:0x7864040
y.create.l HWIO_SDC2_SDCC_MCI_FIFO_COUNT_ADDR A:0x7864044
y.create.l HWIO_SDC2_SDCC_MCI_BOOT_ADDR A:0x7864048
y.create.l HWIO_SDC2_SDCC_MCI_BOOT_ACK_TIMER_ADDR A:0x786404c
y.create.l HWIO_SDC2_SDCC_MCI_VERSION_ADDR A:0x7864050
y.create.l HWIO_SDC2_SDCC_MCI_EMULATION_DLY_LINE_ADDR A:0x7864054
y.create.l HWIO_SDC2_SDCC_MCI_CCS_TIMER_ADDR A:0x7864058
y.create.l HWIO_SDC2_SDCC_MCI_RESPONSE_MASK_ADDR A:0x786405c
y.create.l HWIO_SDC2_SDCC_MCI_DLL_CONFIG_ADDR A:0x7864060
y.create.l HWIO_SDC2_SDCC_MCI_DLL_TEST_CTL_ADDR A:0x7864064
y.create.l HWIO_SDC2_SDCC_MCI_DLL_STATUS_ADDR A:0x7864068
y.create.l HWIO_SDC2_SDCC_MCI_STATUS2_ADDR A:0x786406c
y.create.l HWIO_SDC2_SDCC_MCI_GENERICS_ADDR A:0x7864070
y.create.l HWIO_SDC2_SDCC_MCI_FIFO_STATUS_ADDR A:0x7864074
y.create.l HWIO_SDC2_SDCC_MCI_HC_MODE_ADDR A:0x7864078
y.create.l HWIO_SDC2_SDCC_MCI_FIFO0_ADDR A:0x7864080
y.create.l HWIO_SDC2_SDCC_MCI_FIFO1_ADDR A:0x7864084
y.create.l HWIO_SDC2_SDCC_MCI_FIFO2_ADDR A:0x7864088
y.create.l HWIO_SDC2_SDCC_MCI_FIFO3_ADDR A:0x786408c
y.create.l HWIO_SDC2_SDCC_MCI_FIFO4_ADDR A:0x7864090
y.create.l HWIO_SDC2_SDCC_MCI_FIFO5_ADDR A:0x7864094
y.create.l HWIO_SDC2_SDCC_MCI_FIFO6_ADDR A:0x7864098
y.create.l HWIO_SDC2_SDCC_MCI_FIFO7_ADDR A:0x786409c
y.create.l HWIO_SDC2_SDCC_MCI_FIFO8_ADDR A:0x78640a0
y.create.l HWIO_SDC2_SDCC_MCI_FIFO9_ADDR A:0x78640a4
y.create.l HWIO_SDC2_SDCC_MCI_TESTBUS_CONFIG_ADDR A:0x78640cc
y.create.l HWIO_SDC2_SDCC_MCI_TEST_CTL_ADDR A:0x78640d0
y.create.l HWIO_SDC2_SDCC_MCI_TEST_INPUT_ADDR A:0x78640d4
y.create.l HWIO_SDC2_SDCC_MCI_TEST_OUT_ADDR A:0x78640d8
y.create.l HWIO_SDC2_SDCC_MCI_PWRCTL_STATUS_REG_ADDR A:0x78640dc
y.create.l HWIO_SDC2_SDCC_MCI_PWRCTL_MASK_REG_ADDR A:0x78640e0
y.create.l HWIO_SDC2_SDCC_MCI_PWRCTL_CLEAR_REG_ADDR A:0x78640e4
y.create.l HWIO_SDC2_SDCC_MCI_PWRCTL_CTL_REG_ADDR A:0x78640e8
y.create.l HWIO_SDC2_SDCC_MCI_CLEAR2_ADDR A:0x78640ec
y.create.l HWIO_SDC2_SDCC_MCI_INT_MASKINT2_0_ADDR A:0x78640f0
y.create.l HWIO_SDC2_SDCC_MCI_INT_MASKINT2_1_ADDR A:0x78640f4
y.create.l HWIO_SDC2_SDCC_CHAR_CFG_ADDR A:0x78640fc
y.create.l HWIO_SDC2_SDCC_CHAR_CMD_ADDR A:0x7864100
y.create.l HWIO_SDC2_SDCC_CHAR_DATA_0_ADDR A:0x7864104
y.create.l HWIO_SDC2_SDCC_CHAR_DATA_1_ADDR A:0x7864108
y.create.l HWIO_SDC2_SDCC_CHAR_DATA_2_ADDR A:0x786410c
y.create.l HWIO_SDC2_SDCC_CHAR_DATA_3_ADDR A:0x7864110
y.create.l HWIO_SDC2_SDCC_CHAR_DATA_4_ADDR A:0x7864114
y.create.l HWIO_SDC2_SDCC_CHAR_DATA_5_ADDR A:0x7864118
y.create.l HWIO_SDC2_SDCC_CHAR_DATA_6_ADDR A:0x786411c
y.create.l HWIO_SDC2_SDCC_CHAR_DATA_7_ADDR A:0x7864120
y.create.l HWIO_SDC2_SDCC_DEBUG_REG_ADDR A:0x7864124
y.create.l HWIO_SDC2_SDCC_IP_CATALOG_ADDR A:0x7864128
y.create.l HWIO_SDC2_SDCC_QSB_VALUES_ADDR A:0x786412c
y.create.l HWIO_SDC2_SDCC_QSB_AXI_VALUES_ADDR A:0x7864130
y.create.l HWIO_SDC2_SDCC_AXI_DATA_ERR_DBUG_ADDR A:0x7864134
y.create.l HWIO_SDC2_SDCC_T4_DLY_CTRL_ADDR A:0x7864138
y.create.l HWIO_SDC2_SDCC_T4_DLY_STAT_ADDR A:0x786413c
y.create.l HWIO_SDC2_SDCC_CSR_CDC_CTLR_CFG0_ADDR A:0x7864140
y.create.l HWIO_SDC2_SDCC_CSR_CDC_CTLR_CFG1_ADDR A:0x7864144
y.create.l HWIO_SDC2_SDCC_CSR_CDC_CAL_TIMER_CFG0_ADDR A:0x7864148
y.create.l HWIO_SDC2_SDCC_CSR_CDC_CAL_TIMER_CFG1_ADDR A:0x786414c
y.create.l HWIO_SDC2_SDCC_CSR_CDC_REFCOUNT_CFG_ADDR A:0x7864150
y.create.l HWIO_SDC2_SDCC_CSR_CDC_COARSE_CAL_CFG_ADDR A:0x7864154
y.create.l HWIO_SDC2_SDCC_CSR_CDC_RSVD_CFG_ADDR A:0x7864158
y.create.l HWIO_SDC2_SDCC_CSR_CDC_OFFSET_CFG_ADDR A:0x786415c
y.create.l HWIO_SDC2_SDCC_CSR_CDC_DELAY_CFG_ADDR A:0x7864160
y.create.l HWIO_SDC2_SDCC_CSR_CDC_SW_MODE_CFG_ADDR A:0x7864164
y.create.l HWIO_SDC2_SDCC_CSR_CDC_TEST_CFG_ADDR A:0x7864168
y.create.l HWIO_SDC2_SDCC_CSR_CDC_SW_OVRD_CFG_ADDR A:0x786416c
y.create.l HWIO_SDC2_SDCC_CSR_CDC_SLAVE_DDA_CFG_ADDR A:0x7864170
y.create.l HWIO_SDC2_SDCC_CSR_CDC_STATUS0_ADDR A:0x7864174
y.create.l HWIO_SDC2_SDCC_CSR_CDC_STATUS1_ADDR A:0x7864178
y.create.l HWIO_SDC2_SDCC_CSR_CDC_STATUS2_ADDR A:0x786417c
y.create.l HWIO_SDC2_SDCC_CSR_CDC_STATUS3_ADDR A:0x7864180
y.create.l HWIO_SDC2_SDCC_CSR_CDC_STATUS4_ADDR A:0x7864184
y.create.l HWIO_SDC2_SDCC_CSR_CDC_GEN_CFG_ADDR A:0x7864188
y.create.l HWIO_SDC2_SDCC_CDC_AUTO_SW_CAL_CFG_ADDR A:0x786418c
y.create.l HWIO_SDC2_SDCC_DDR200_STAT_ADDR A:0x7864190
y.create.l HWIO_SDC2_SDCC_DDR200_CFG_ADDR A:0x7864194
y.create.l HWIO_SDC2_SDCC_TIME_COUNT_CTRL_ADDR A:0x7864198
y.create.l HWIO_SDC2_SDCC_FLOW_CTRL_TIME_COUNT_ADDR A:0x786419c
y.create.l HWIO_SDC2_SDCC_BUSY_TIME_COUNT_ADDR A:0x78641a0
y.create.l HWIO_SDC2_SDCC_DATA_TIME_COUNT_ADDR A:0x78641a4
y.create.l HWIO_SDC2_SDCC_CMD_TIME_COUNT_ADDR A:0x78641a8
y.create.l HWIO_SDC2_SDCC_MCI_DLL_CONFIG_2_ADDR A:0x78641ac
y.create.l HWIO_SDC2_SDCC_MCI_DDR_CONFIG_ADDR A:0x78641b0
y.create.l HWIO_SDC2_SDCC_MCI_FIFO_ALT0_ADDR A:0x7864400
y.create.l HWIO_SDC2_SDCC_MCI_FIFO_ALT1_ADDR A:0x7864404
y.create.l HWIO_SDC2_SDCC_MCI_FIFO_ALT2_ADDR A:0x7864408
y.create.l HWIO_SDC2_SDCC_MCI_FIFO_ALT3_ADDR A:0x786440c
y.create.l HWIO_SDC2_SDCC_MCI_FIFO_ALT4_ADDR A:0x7864410
y.create.l HWIO_SDC2_SDCC_MCI_FIFO_ALT5_ADDR A:0x7864414
y.create.l HWIO_SDC2_SDCC_MCI_FIFO_ALT6_ADDR A:0x7864418
y.create.l HWIO_SDC2_SDCC_MCI_FIFO_ALT7_ADDR A:0x786441c
y.create.l HWIO_SDC2_SDCC_MCI_FIFO_ALT8_ADDR A:0x7864420
y.create.l HWIO_SDC2_SDCC_MCI_FIFO_ALT9_ADDR A:0x7864424
y.create.l HWIO_SDC2_SDCC_HC_REG_0_2_ADDR A:0x7864900
y.create.l HWIO_SDC2_SDCC_HC_REG_4_6_ADDR A:0x7864904
y.create.l HWIO_SDC2_SDCC_HC_REG_8_A_ADDR A:0x7864908
y.create.l HWIO_SDC2_SDCC_HC_REG_C_E_ADDR A:0x786490c
y.create.l HWIO_SDC2_SDCC_HC_REG_10_12_ADDR A:0x7864910
y.create.l HWIO_SDC2_SDCC_HC_REG_14_16_ADDR A:0x7864914
y.create.l HWIO_SDC2_SDCC_HC_REG_18_1A_ADDR A:0x7864918
y.create.l HWIO_SDC2_SDCC_HC_REG_1C_1E_ADDR A:0x786491c
y.create.l HWIO_SDC2_SDCC_HC_REG_20_22_ADDR A:0x7864920
y.create.l HWIO_SDC2_SDCC_HC_REG_24_26_ADDR A:0x7864924
y.create.l HWIO_SDC2_SDCC_HC_REG_28_2A_ADDR A:0x7864928
y.create.l HWIO_SDC2_SDCC_HC_REG_2C_2E_ADDR A:0x786492c
y.create.l HWIO_SDC2_SDCC_HC_REG_30_32_ADDR A:0x7864930
y.create.l HWIO_SDC2_SDCC_HC_REG_34_36_ADDR A:0x7864934
y.create.l HWIO_SDC2_SDCC_HC_REG_38_3A_ADDR A:0x7864938
y.create.l HWIO_SDC2_SDCC_HC_REG_3C_3E_ADDR A:0x786493c
y.create.l HWIO_SDC2_SDCC_HC_REG_40_42_ADDR A:0x7864940
y.create.l HWIO_SDC2_SDCC_HC_REG_44_46_ADDR A:0x7864944
y.create.l HWIO_SDC2_SDCC_HC_REG_48_4A_ADDR A:0x7864948
y.create.l HWIO_SDC2_SDCC_HC_REG_50_52_ADDR A:0x7864950
y.create.l HWIO_SDC2_SDCC_HC_REG_54_56_ADDR A:0x7864954
y.create.l HWIO_SDC2_SDCC_HC_REG_58_5A_ADDR A:0x7864958
y.create.l HWIO_SDC2_SDCC_HC_REG_5C_5E_ADDR A:0x786495c
y.create.l HWIO_SDC2_SDCC_HC_REG_60_62_ADDR A:0x7864960
y.create.l HWIO_SDC2_SDCC_HC_REG_64_66_ADDR A:0x7864964
y.create.l HWIO_SDC2_SDCC_HC_REG_68_6A_ADDR A:0x7864968
y.create.l HWIO_SDC2_SDCC_HC_REG_6C_6E_ADDR A:0x786496c
y.create.l HWIO_SDC2_SDCC_HC_REG_E0_E2_ADDR A:0x78649e0
y.create.l HWIO_SDC2_SDCC_HC_REG_FC_FE_ADDR A:0x78649fc
y.create.l HWIO_SDC2_SDCC_HC_REG_DLL_CONFIG_ADDR A:0x7864a00
y.create.l HWIO_SDC2_SDCC_HC_REG_DLL_TEST_CTL_ADDR A:0x7864a04
y.create.l HWIO_SDC2_SDCC_HC_REG_DLL_STATUS_ADDR A:0x7864a08
y.create.l HWIO_SDC2_SDCC_HC_VENDOR_SPECIFIC_FUNC_ADDR A:0x7864a0c
y.create.l HWIO_SDC2_SDCC_HC_VENDOR_SPECIFIC_FUNC2_ADDR A:0x7864a10
y.create.l HWIO_SDC2_SDCC_HC_VENDOR_SPECIFIC_ADMA_ERR_ADDR0_ADDR A:0x7864a14
y.create.l HWIO_SDC2_SDCC_HC_VENDOR_SPECIFIC_ADMA_ERR_ADDR1_ADDR A:0x7864a18
y.create.l HWIO_SDC2_SDCC_HC_VENDOR_SPECIFIC_CAPABILITIES0_ADDR A:0x7864a1c
y.create.l HWIO_SDC2_SDCC_HC_VENDOR_SPECIFIC_CAPABILITIES1_ADDR A:0x7864a20
y.create.l HWIO_SDC2_SDCC_HC_VENDOR_SPECIFIC_T4_DLY_CTRL_ADDR A:0x7864a24
y.create.l HWIO_SDC2_SDCC_HC_VENDOR_SPECIFIC_T4_DLY_STAT_ADDR A:0x7864a28
y.create.l HWIO_SDC2_SDCC_HC_VENDOR_SPECIFIC_CSR_CDC_CTLR_CFG0_ADDR A:0x7864a30
y.create.l HWIO_SDC2_SDCC_HC_VENDOR_SPECIFIC_CSR_CDC_CTLR_CFG1_ADDR A:0x7864a34
y.create.l HWIO_SDC2_SDCC_HC_VENDOR_SPECIFIC_CSR_CDC_CAL_TIMER_CFG0_ADDR A:0x7864a38
y.create.l HWIO_SDC2_SDCC_HC_VENDOR_SPECIFIC_CSR_CDC_CAL_TIMER_CFG1_ADDR A:0x7864a3c
y.create.l HWIO_SDC2_SDCC_HC_VENDOR_SPECIFIC_CSR_CDC_REFCOUNT_CFG_ADDR A:0x7864a40
y.create.l HWIO_SDC2_SDCC_HC_VENDOR_SPECIFIC_CSR_CDC_COARSE_CAL_CFG_ADDR A:0x7864a44
y.create.l HWIO_SDC2_SDCC_HC_VENDOR_SPECIFIC_CSR_CDC_RSVD_CFG_ADDR A:0x7864a48
y.create.l HWIO_SDC2_SDCC_HC_VENDOR_SPECIFIC_CSR_CDC_OFFSET_CFG_ADDR A:0x7864a4c
y.create.l HWIO_SDC2_SDCC_HC_VENDOR_SPECIFIC_CSR_CDC_DELAY_CFG_ADDR A:0x7864a50
y.create.l HWIO_SDC2_SDCC_HC_VENDOR_SPECIFIC_CSR_CDC_SW_MODE_CFG_ADDR A:0x7864a54
y.create.l HWIO_SDC2_SDCC_HC_VENDOR_SPECIFIC_CSR_CDC_TEST_CFG_ADDR A:0x7864a58
y.create.l HWIO_SDC2_SDCC_HC_VENDOR_SPECIFIC_CSR_CDC_SW_OVRD_CFG_ADDR A:0x7864a5c
y.create.l HWIO_SDC2_SDCC_HC_VENDOR_SPECIFIC_CSR_CDC_SLAVE_DDA_CFG_ADDR A:0x7864a60
y.create.l HWIO_SDC2_SDCC_HC_VENDOR_SPECIFIC_CSR_CDC_STATUS0_ADDR A:0x7864a64
y.create.l HWIO_SDC2_SDCC_HC_VENDOR_SPECIFIC_CSR_CDC_STATUS1_ADDR A:0x7864a68
y.create.l HWIO_SDC2_SDCC_HC_VENDOR_SPECIFIC_CSR_CDC_STATUS2_ADDR A:0x7864a6c
y.create.l HWIO_SDC2_SDCC_HC_VENDOR_SPECIFIC_CSR_CDC_STATUS3_ADDR A:0x7864a70
y.create.l HWIO_SDC2_SDCC_HC_VENDOR_SPECIFIC_CSR_CDC_STATUS4_ADDR A:0x7864a74
y.create.l HWIO_SDC2_SDCC_HC_VENDOR_SPECIFIC_CSR_CDC_GEN_CFG_ADDR A:0x7864a78
y.create.l HWIO_SDC2_SDCC_HC_VENDOR_SPECIFIC_CDC_AUTO_SW_CAL_CFG_ADDR A:0x7864a7c
y.create.l HWIO_SDC2_SDCC_HC_VENDOR_SPECIFIC_DDR200_STAT_ADDR A:0x7864a80
y.create.l HWIO_SDC2_SDCC_HC_VENDOR_SPECIFIC_DDR200_CFG_ADDR A:0x7864a84
y.create.l HWIO_SDC2_SDCC_HC_VENDOR_SPECIFIC_TIME_COUNT_CTRL_ADDR A:0x7864a88
y.create.l HWIO_SDC2_SDCC_HC_VENDOR_SPECIFIC_FLOW_CTRL_TIME_COUNT_ADDR A:0x7864a8c
y.create.l HWIO_SDC2_SDCC_HC_VENDOR_SPECIFIC_BUSY_TIME_COUNT_ADDR A:0x7864a90
y.create.l HWIO_SDC2_SDCC_HC_VENDOR_SPECIFIC_DATA_TIME_COUNT_ADDR A:0x7864a94
y.create.l HWIO_SDC2_SDCC_HC_VENDOR_SPECIFIC_CMD_TIME_COUNT_ADDR A:0x7864a98
y.create.l HWIO_SDC2_SDCC_HC_VENDOR_SPECIFIC_ERR_INT_STS_ADDR A:0x7864a9c
y.create.l HWIO_SDC2_SDCC_HC_VENDOR_SPECIFIC_PWRCTL_STATUS_REG_ADDR A:0x7864aa0
y.create.l HWIO_SDC2_SDCC_HC_VENDOR_SPECIFIC_PWRCTL_MASK_REG_ADDR A:0x7864aa4
y.create.l HWIO_SDC2_SDCC_HC_VENDOR_SPECIFIC_PWRCTL_CLEAR_REG_ADDR A:0x7864aa8
y.create.l HWIO_SDC2_SDCC_HC_VENDOR_SPECIFIC_PWRCTL_CTL_REG_ADDR A:0x7864aac
y.create.l HWIO_SDC2_SDCC_HC_VENDOR_SPECIFIC_FUNC3_ADDR A:0x7864ab0
y.create.l HWIO_SDC2_SDCC_HC_REG_DLL_CONFIG_2_ADDR A:0x7864ab4
y.create.l HWIO_SDC2_SDCC_HC_REG_DDR_CONFIG_ADDR A:0x7864ab8
y.create.l HWIO_QFPROM_RAW_JTAG_ID_ADDR A:0x58000
y.create.l HWIO_QFPROM_RAW_PTE1_ADDR A:0x58004
y.create.l HWIO_QFPROM_RAW_SERIAL_NUM_ADDR A:0x58008
y.create.l HWIO_QFPROM_RAW_PTE2_ADDR A:0x5800c
y.create.l HWIO_QFPROM_RAW_RD_WR_PERM_LSB_ADDR A:0x58010
y.create.l HWIO_QFPROM_RAW_RD_WR_PERM_MSB_ADDR A:0x58014
y.create.l HWIO_QFPROM_RAW_ANTI_ROLLBACK_1_LSB_ADDR A:0x58018
y.create.l HWIO_QFPROM_RAW_ANTI_ROLLBACK_1_MSB_ADDR A:0x5801c
y.create.l HWIO_QFPROM_RAW_ANTI_ROLLBACK_2_LSB_ADDR A:0x58020
y.create.l HWIO_QFPROM_RAW_ANTI_ROLLBACK_2_MSB_ADDR A:0x58024
y.create.l HWIO_QFPROM_RAW_ANTI_ROLLBACK_3_LSB_ADDR A:0x58028
y.create.l HWIO_QFPROM_RAW_ANTI_ROLLBACK_3_MSB_ADDR A:0x5802c
y.create.l HWIO_QFPROM_RAW_OEM_CONFIG_ROW0_LSB_ADDR A:0x58030
y.create.l HWIO_QFPROM_RAW_OEM_CONFIG_ROW0_MSB_ADDR A:0x58034
y.create.l HWIO_QFPROM_RAW_OEM_CONFIG_ROW1_LSB_ADDR A:0x58038
y.create.l HWIO_QFPROM_RAW_OEM_CONFIG_ROW1_MSB_ADDR A:0x5803c
y.create.l HWIO_QFPROM_RAW_FEAT_CONFIG_ROW0_LSB_ADDR A:0x58040
y.create.l HWIO_QFPROM_RAW_FEAT_CONFIG_ROW0_MSB_ADDR A:0x58044
y.create.l HWIO_QFPROM_RAW_FEAT_CONFIG_ROW1_LSB_ADDR A:0x58048
y.create.l HWIO_QFPROM_RAW_FEAT_CONFIG_ROW1_MSB_ADDR A:0x5804c
y.create.l HWIO_QFPROM_RAW_FEAT_CONFIG_ROW2_LSB_ADDR A:0x58050
y.create.l HWIO_QFPROM_RAW_FEAT_CONFIG_ROW2_MSB_ADDR A:0x58054
y.create.l HWIO_QFPROM_RAW_PRI_KEY_DERIVATION_KEY_ROW0_LSB_ADDR A:0x58058
y.create.l HWIO_QFPROM_RAW_PRI_KEY_DERIVATION_KEY_ROW1_LSB_ADDR A:0x58060
y.create.l HWIO_QFPROM_RAW_PRI_KEY_DERIVATION_KEY_ROW2_LSB_ADDR A:0x58068
y.create.l HWIO_QFPROM_RAW_PRI_KEY_DERIVATION_KEY_ROW3_LSB_ADDR A:0x58070
y.create.l HWIO_QFPROM_RAW_PRI_KEY_DERIVATION_KEY_ROW0_MSB_ADDR A:0x5805c
y.create.l HWIO_QFPROM_RAW_PRI_KEY_DERIVATION_KEY_ROW1_MSB_ADDR A:0x58064
y.create.l HWIO_QFPROM_RAW_PRI_KEY_DERIVATION_KEY_ROW2_MSB_ADDR A:0x5806c
y.create.l HWIO_QFPROM_RAW_PRI_KEY_DERIVATION_KEY_ROW3_MSB_ADDR A:0x58074
y.create.l HWIO_QFPROM_RAW_SEC_KEY_DERIVATION_KEY_ROW0_LSB_ADDR A:0x58078
y.create.l HWIO_QFPROM_RAW_SEC_KEY_DERIVATION_KEY_ROW1_LSB_ADDR A:0x58080
y.create.l HWIO_QFPROM_RAW_SEC_KEY_DERIVATION_KEY_ROW2_LSB_ADDR A:0x58088
y.create.l HWIO_QFPROM_RAW_SEC_KEY_DERIVATION_KEY_ROW3_LSB_ADDR A:0x58090
y.create.l HWIO_QFPROM_RAW_SEC_KEY_DERIVATION_KEY_ROW0_MSB_ADDR A:0x5807c
y.create.l HWIO_QFPROM_RAW_SEC_KEY_DERIVATION_KEY_ROW1_MSB_ADDR A:0x58084
y.create.l HWIO_QFPROM_RAW_SEC_KEY_DERIVATION_KEY_ROW2_MSB_ADDR A:0x5808c
y.create.l HWIO_QFPROM_RAW_SEC_KEY_DERIVATION_KEY_ROW3_MSB_ADDR A:0x58094
y.create.l HWIO_QFPROM_RAW_OEM_SEC_BOOT_ROW0_LSB_ADDR A:0x58098
y.create.l HWIO_QFPROM_RAW_OEM_SEC_BOOT_ROW0_MSB_ADDR A:0x5809c
y.create.l HWIO_QFPROM_RAW_CALIB2_ROW0_LSB_ADDR A:0x580a0
y.create.l HWIO_QFPROM_RAW_CALIB2_ROW0_MSB_ADDR A:0x580a4
y.create.l HWIO_QFPROM_RAW_PK_HASH_ROW0_LSB_ADDR A:0x580a8
y.create.l HWIO_QFPROM_RAW_PK_HASH_ROW1_LSB_ADDR A:0x580b0
y.create.l HWIO_QFPROM_RAW_PK_HASH_ROW2_LSB_ADDR A:0x580b8
y.create.l HWIO_QFPROM_RAW_PK_HASH_ROW3_LSB_ADDR A:0x580c0
y.create.l HWIO_QFPROM_RAW_PK_HASH_ROW0_MSB_ADDR A:0x580ac
y.create.l HWIO_QFPROM_RAW_PK_HASH_ROW1_MSB_ADDR A:0x580b4
y.create.l HWIO_QFPROM_RAW_PK_HASH_ROW2_MSB_ADDR A:0x580bc
y.create.l HWIO_QFPROM_RAW_PK_HASH_ROW3_MSB_ADDR A:0x580c4
y.create.l HWIO_QFPROM_RAW_PK_HASH_ROW4_LSB_ADDR A:0x580c8
y.create.l HWIO_QFPROM_RAW_PK_HASH_ROW4_MSB_ADDR A:0x580cc
y.create.l HWIO_QFPROM_RAW_CALIB_ROW0_LSB_ADDR A:0x580d0
y.create.l HWIO_QFPROM_RAW_CALIB_ROW0_MSB_ADDR A:0x580d4
y.create.l HWIO_QFPROM_RAW_CALIB_ROW1_LSB_ADDR A:0x580d8
y.create.l HWIO_QFPROM_RAW_CALIB_ROW1_MSB_ADDR A:0x580dc
y.create.l HWIO_QFPROM_RAW_CALIB_ROW2_LSB_ADDR A:0x580e0
y.create.l HWIO_QFPROM_RAW_CALIB_ROW2_MSB_ADDR A:0x580e4
y.create.l HWIO_QFPROM_RAW_CALIB_ROW3_LSB_ADDR A:0x580e8
y.create.l HWIO_QFPROM_RAW_CALIB_ROW3_MSB_ADDR A:0x580ec
y.create.l HWIO_QFPROM_RAW_MEM_CONFIG_ROW0_LSB_ADDR A:0x580f0
y.create.l HWIO_QFPROM_RAW_MEM_CONFIG_ROW1_LSB_ADDR A:0x580f8
y.create.l HWIO_QFPROM_RAW_MEM_CONFIG_ROW2_LSB_ADDR A:0x58100
y.create.l HWIO_QFPROM_RAW_MEM_CONFIG_ROW3_LSB_ADDR A:0x58108
y.create.l HWIO_QFPROM_RAW_MEM_CONFIG_ROW0_MSB_ADDR A:0x580f4
y.create.l HWIO_QFPROM_RAW_MEM_CONFIG_ROW1_MSB_ADDR A:0x580fc
y.create.l HWIO_QFPROM_RAW_MEM_CONFIG_ROW2_MSB_ADDR A:0x58104
y.create.l HWIO_QFPROM_RAW_MEM_CONFIG_ROW3_MSB_ADDR A:0x5810c
y.create.l HWIO_QFPROM_RAW_MEM_CONFIG_ROW4_LSB_ADDR A:0x58110
y.create.l HWIO_QFPROM_RAW_MEM_CONFIG_ROW4_MSB_ADDR A:0x58114
y.create.l HWIO_QFPROM_RAW_ROM_PATCH_ADDR_ROW0_LSB_ADDR A:0x58118
y.create.l HWIO_QFPROM_RAW_ROM_PATCH_ADDR_ROW1_LSB_ADDR A:0x58120
y.create.l HWIO_QFPROM_RAW_ROM_PATCH_ADDR_ROW2_LSB_ADDR A:0x58128
y.create.l HWIO_QFPROM_RAW_ROM_PATCH_ADDR_ROW3_LSB_ADDR A:0x58130
y.create.l HWIO_QFPROM_RAW_ROM_PATCH_ADDR_ROW4_LSB_ADDR A:0x58138
y.create.l HWIO_QFPROM_RAW_ROM_PATCH_ADDR_ROW5_LSB_ADDR A:0x58140
y.create.l HWIO_QFPROM_RAW_ROM_PATCH_ADDR_ROW6_LSB_ADDR A:0x58148
y.create.l HWIO_QFPROM_RAW_ROM_PATCH_ADDR_ROW0_MSB_ADDR A:0x5811c
y.create.l HWIO_QFPROM_RAW_ROM_PATCH_ADDR_ROW1_MSB_ADDR A:0x58124
y.create.l HWIO_QFPROM_RAW_ROM_PATCH_ADDR_ROW2_MSB_ADDR A:0x5812c
y.create.l HWIO_QFPROM_RAW_ROM_PATCH_ADDR_ROW3_MSB_ADDR A:0x58134
y.create.l HWIO_QFPROM_RAW_ROM_PATCH_ADDR_ROW4_MSB_ADDR A:0x5813c
y.create.l HWIO_QFPROM_RAW_ROM_PATCH_ADDR_ROW5_MSB_ADDR A:0x58144
y.create.l HWIO_QFPROM_RAW_ROM_PATCH_ADDR_ROW6_MSB_ADDR A:0x5814c
y.create.l HWIO_QFPROM_RAW_ROM_PATCH_ADDR_ROW7_LSB_ADDR A:0x58150
y.create.l HWIO_QFPROM_RAW_ROM_PATCH_ADDR_ROW7_MSB_ADDR A:0x58154
y.create.l HWIO_QFPROM_RAW_ROM_PATCH_DATA_ROW0_LSB_ADDR A:0x58158
y.create.l HWIO_QFPROM_RAW_ROM_PATCH_DATA_ROW1_LSB_ADDR A:0x58160
y.create.l HWIO_QFPROM_RAW_ROM_PATCH_DATA_ROW2_LSB_ADDR A:0x58168
y.create.l HWIO_QFPROM_RAW_ROM_PATCH_DATA_ROW3_LSB_ADDR A:0x58170
y.create.l HWIO_QFPROM_RAW_ROM_PATCH_DATA_ROW4_LSB_ADDR A:0x58178
y.create.l HWIO_QFPROM_RAW_ROM_PATCH_DATA_ROW5_LSB_ADDR A:0x58180
y.create.l HWIO_QFPROM_RAW_ROM_PATCH_DATA_ROW6_LSB_ADDR A:0x58188
y.create.l HWIO_QFPROM_RAW_ROM_PATCH_DATA_ROW7_LSB_ADDR A:0x58190
y.create.l HWIO_QFPROM_RAW_ROM_PATCH_DATA_ROW8_LSB_ADDR A:0x58198
y.create.l HWIO_QFPROM_RAW_ROM_PATCH_DATA_ROW9_LSB_ADDR A:0x581a0
y.create.l HWIO_QFPROM_RAW_ROM_PATCH_DATA_ROW0_MSB_ADDR A:0x5815c
y.create.l HWIO_QFPROM_RAW_ROM_PATCH_DATA_ROW1_MSB_ADDR A:0x58164
y.create.l HWIO_QFPROM_RAW_ROM_PATCH_DATA_ROW2_MSB_ADDR A:0x5816c
y.create.l HWIO_QFPROM_RAW_ROM_PATCH_DATA_ROW3_MSB_ADDR A:0x58174
y.create.l HWIO_QFPROM_RAW_ROM_PATCH_DATA_ROW4_MSB_ADDR A:0x5817c
y.create.l HWIO_QFPROM_RAW_ROM_PATCH_DATA_ROW5_MSB_ADDR A:0x58184
y.create.l HWIO_QFPROM_RAW_ROM_PATCH_DATA_ROW6_MSB_ADDR A:0x5818c
y.create.l HWIO_QFPROM_RAW_ROM_PATCH_DATA_ROW7_MSB_ADDR A:0x58194
y.create.l HWIO_QFPROM_RAW_ROM_PATCH_DATA_ROW8_MSB_ADDR A:0x5819c
y.create.l HWIO_QFPROM_RAW_ROM_PATCH_DATA_ROW9_MSB_ADDR A:0x581a4
y.create.l HWIO_QFPROM_RAW_ROM_PATCH_EN_LSB_ADDR A:0x581d0
y.create.l HWIO_QFPROM_RAW_ROM_PATCH_EN_MSB_ADDR A:0x581d4
y.create.l HWIO_QFPROM_RAW_SPARE_REG15_LSB_ADDR A:0x581d8
y.create.l HWIO_QFPROM_RAW_SPARE_REG15_MSB_ADDR A:0x581dc
y.create.l HWIO_QFPROM_RAW_SPARE_REG16_LSB_ADDR A:0x581e0
y.create.l HWIO_QFPROM_RAW_SPARE_REG16_MSB_ADDR A:0x581e4
y.create.l HWIO_QFPROM_RAW_SPARE_REG17_LSB_ADDR A:0x581e8
y.create.l HWIO_QFPROM_RAW_SPARE_REG17_MSB_ADDR A:0x581ec
y.create.l HWIO_QFPROM_RAW_SPARE_REG18_LSB_ADDR A:0x581f0
y.create.l HWIO_QFPROM_RAW_SPARE_REG18_MSB_ADDR A:0x581f4
y.create.l HWIO_QFPROM_RAW_SPARE_REG19_LSB_ADDR A:0x581f8
y.create.l HWIO_QFPROM_RAW_SPARE_REG19_MSB_ADDR A:0x581fc
y.create.l HWIO_QFPROM_RAW_ACC_PRIVATE0_ADDR A:0x58200
y.create.l HWIO_QFPROM_RAW_ACC_PRIVATE1_ADDR A:0x58204
y.create.l HWIO_QFPROM_RAW_ACC_PRIVATE2_ADDR A:0x58208
y.create.l HWIO_QFPROM_RAW_ACC_PRIVATE3_ADDR A:0x5820c
y.create.l HWIO_QFPROM_RAW_ACC_PRIVATE4_ADDR A:0x58210
y.create.l HWIO_QFPROM_RAW_ACC_PRIVATE5_ADDR A:0x58214
y.create.l HWIO_QFPROM_RAW_ACC_PRIVATE6_ADDR A:0x58218
y.create.l HWIO_QFPROM_RAW_ACC_PRIVATE7_ADDR A:0x5821c
y.create.l HWIO_QFPROM_RAW_ACC_PRIVATE8_ADDR A:0x58220
y.create.l HWIO_QFPROM_RAW_ACC_PRIVATE9_ADDR A:0x58224
y.create.l HWIO_ACC_IR_ADDR A:0x5a000
y.create.l HWIO_ACC_DR_ADDR A:0x5a004
y.create.l HWIO_ACC_VERID_ADDR A:0x5a008
y.create.l HWIO_ACC_FEATSET0_ADDR A:0x5a010
y.create.l HWIO_ACC_FEATSET1_ADDR A:0x5a014
y.create.l HWIO_ACC_FEATSET2_ADDR A:0x5a018
y.create.l HWIO_ACC_FEATSET3_ADDR A:0x5a01c
y.create.l HWIO_ACC_FEATSET4_ADDR A:0x5a020
y.create.l HWIO_ACC_FEATSET5_ADDR A:0x5a024
y.create.l HWIO_ACC_FEATSET6_ADDR A:0x5a028
y.create.l HWIO_ACC_FEATSET7_ADDR A:0x5a02c
y.create.l HWIO_ACC_STATE_ADDR A:0x5a038
y.create.l HWIO_QFPROM_BLOW_TIMER_ADDR A:0x5a03c
y.create.l HWIO_QFPROM_TEST_CTRL_ADDR A:0x5a040
y.create.l HWIO_QFPROM_ACCEL_ADDR A:0x5a044
y.create.l HWIO_QFPROM_BLOW_STATUS_ADDR A:0x5a048
y.create.l HWIO_QFPROM_ROM_ERROR_ADDR A:0x5a04c
y.create.l HWIO_QFPROM_BIST_CTRL_ADDR A:0x5a050
y.create.l HWIO_QFPROM_BIST_ERROR_ADDR A:0x5a054
y.create.l HWIO_QFPROM_HASH_SIGNATURE0_ADDR A:0x5a060
y.create.l HWIO_QFPROM_HASH_SIGNATURE1_ADDR A:0x5a064
y.create.l HWIO_QFPROM_HASH_SIGNATURE2_ADDR A:0x5a068
y.create.l HWIO_QFPROM_HASH_SIGNATURE3_ADDR A:0x5a06c
y.create.l HWIO_QFPROM_HASH_SIGNATURE4_ADDR A:0x5a070
y.create.l HWIO_QFPROM_HASH_SIGNATURE5_ADDR A:0x5a074
y.create.l HWIO_QFPROM_HASH_SIGNATURE6_ADDR A:0x5a078
y.create.l HWIO_QFPROM_HASH_SIGNATURE7_ADDR A:0x5a07c
y.create.l HWIO_HW_KEY_STATUS_ADDR A:0x5a080
y.create.l HWIO_RESET_JDR_STATUS_ADDR A:0x5a084
y.create.l HWIO_FEC_ESR_ADDR A:0x5a090
y.create.l HWIO_FEC_EAR_ADDR A:0x5a094
y.create.l HWIO_QFPROM_CORR_JTAG_ID_ADDR A:0x5c000
y.create.l HWIO_QFPROM_CORR_PTE1_ADDR A:0x5c004
y.create.l HWIO_QFPROM_CORR_SERIAL_NUM_ADDR A:0x5c008
y.create.l HWIO_QFPROM_CORR_PTE2_ADDR A:0x5c00c
y.create.l HWIO_QFPROM_CORR_RD_WR_PERM_LSB_ADDR A:0x5c010
y.create.l HWIO_QFPROM_CORR_RD_WR_PERM_MSB_ADDR A:0x5c014
y.create.l HWIO_QFPROM_CORR_ANTI_ROLLBACK_1_LSB_ADDR A:0x5c018
y.create.l HWIO_QFPROM_CORR_ANTI_ROLLBACK_1_MSB_ADDR A:0x5c01c
y.create.l HWIO_QFPROM_CORR_ANTI_ROLLBACK_2_LSB_ADDR A:0x5c020
y.create.l HWIO_QFPROM_CORR_ANTI_ROLLBACK_2_MSB_ADDR A:0x5c024
y.create.l HWIO_QFPROM_CORR_ANTI_ROLLBACK_3_LSB_ADDR A:0x5c028
y.create.l HWIO_QFPROM_CORR_ANTI_ROLLBACK_3_MSB_ADDR A:0x5c02c
y.create.l HWIO_QFPROM_CORR_OEM_CONFIG_ROW0_LSB_ADDR A:0x5c030
y.create.l HWIO_QFPROM_CORR_OEM_CONFIG_ROW0_MSB_ADDR A:0x5c034
y.create.l HWIO_QFPROM_CORR_OEM_CONFIG_ROW1_LSB_ADDR A:0x5c038
y.create.l HWIO_QFPROM_CORR_OEM_CONFIG_ROW1_MSB_ADDR A:0x5c03c
y.create.l HWIO_QFPROM_CORR_FEAT_CONFIG_ROW0_LSB_ADDR A:0x5c040
y.create.l HWIO_QFPROM_CORR_FEAT_CONFIG_ROW0_MSB_ADDR A:0x5c044
y.create.l HWIO_QFPROM_CORR_FEAT_CONFIG_ROW1_LSB_ADDR A:0x5c048
y.create.l HWIO_QFPROM_CORR_FEAT_CONFIG_ROW1_MSB_ADDR A:0x5c04c
y.create.l HWIO_QFPROM_CORR_FEAT_CONFIG_ROW2_LSB_ADDR A:0x5c050
y.create.l HWIO_QFPROM_CORR_FEAT_CONFIG_ROW2_MSB_ADDR A:0x5c054
y.create.l HWIO_QFPROM_CORR_PRI_KEY_DERIVATION_KEY_ROW0_LSB_ADDR A:0x5c058
y.create.l HWIO_QFPROM_CORR_PRI_KEY_DERIVATION_KEY_ROW1_LSB_ADDR A:0x5c060
y.create.l HWIO_QFPROM_CORR_PRI_KEY_DERIVATION_KEY_ROW2_LSB_ADDR A:0x5c068
y.create.l HWIO_QFPROM_CORR_PRI_KEY_DERIVATION_KEY_ROW3_LSB_ADDR A:0x5c070
y.create.l HWIO_QFPROM_CORR_PRI_KEY_DERIVATION_KEY_ROW0_MSB_ADDR A:0x5c05c
y.create.l HWIO_QFPROM_CORR_PRI_KEY_DERIVATION_KEY_ROW1_MSB_ADDR A:0x5c064
y.create.l HWIO_QFPROM_CORR_PRI_KEY_DERIVATION_KEY_ROW2_MSB_ADDR A:0x5c06c
y.create.l HWIO_QFPROM_CORR_PRI_KEY_DERIVATION_KEY_ROW3_MSB_ADDR A:0x5c074
y.create.l HWIO_QFPROM_CORR_SEC_KEY_DERIVATION_KEY_ROW0_LSB_ADDR A:0x5c078
y.create.l HWIO_QFPROM_CORR_SEC_KEY_DERIVATION_KEY_ROW1_LSB_ADDR A:0x5c080
y.create.l HWIO_QFPROM_CORR_SEC_KEY_DERIVATION_KEY_ROW2_LSB_ADDR A:0x5c088
y.create.l HWIO_QFPROM_CORR_SEC_KEY_DERIVATION_KEY_ROW3_LSB_ADDR A:0x5c090
y.create.l HWIO_QFPROM_CORR_SEC_KEY_DERIVATION_KEY_ROW0_MSB_ADDR A:0x5c07c
y.create.l HWIO_QFPROM_CORR_SEC_KEY_DERIVATION_KEY_ROW1_MSB_ADDR A:0x5c084
y.create.l HWIO_QFPROM_CORR_SEC_KEY_DERIVATION_KEY_ROW2_MSB_ADDR A:0x5c08c
y.create.l HWIO_QFPROM_CORR_SEC_KEY_DERIVATION_KEY_ROW3_MSB_ADDR A:0x5c094
y.create.l HWIO_QFPROM_CORR_OEM_SEC_BOOT_ROW0_LSB_ADDR A:0x5c098
y.create.l HWIO_QFPROM_CORR_OEM_SEC_BOOT_ROW0_MSB_ADDR A:0x5c09c
y.create.l HWIO_QFPROM_CORR_CALIB2_ROW0_LSB_ADDR A:0x5c0a0
y.create.l HWIO_QFPROM_CORR_CALIB2_ROW0_MSB_ADDR A:0x5c0a4
y.create.l HWIO_QFPROM_CORR_PK_HASH_ROW0_LSB_ADDR A:0x5c0a8
y.create.l HWIO_QFPROM_CORR_PK_HASH_ROW1_LSB_ADDR A:0x5c0b0
y.create.l HWIO_QFPROM_CORR_PK_HASH_ROW2_LSB_ADDR A:0x5c0b8
y.create.l HWIO_QFPROM_CORR_PK_HASH_ROW3_LSB_ADDR A:0x5c0c0
y.create.l HWIO_QFPROM_CORR_PK_HASH_ROW0_MSB_ADDR A:0x5c0ac
y.create.l HWIO_QFPROM_CORR_PK_HASH_ROW1_MSB_ADDR A:0x5c0b4
y.create.l HWIO_QFPROM_CORR_PK_HASH_ROW2_MSB_ADDR A:0x5c0bc
y.create.l HWIO_QFPROM_CORR_PK_HASH_ROW3_MSB_ADDR A:0x5c0c4
y.create.l HWIO_QFPROM_CORR_PK_HASH_ROW4_LSB_ADDR A:0x5c0c8
y.create.l HWIO_QFPROM_CORR_PK_HASH_ROW4_MSB_ADDR A:0x5c0cc
y.create.l HWIO_QFPROM_CORR_CALIB_ROW0_LSB_ADDR A:0x5c0d0
y.create.l HWIO_QFPROM_CORR_CALIB_ROW0_MSB_ADDR A:0x5c0d4
y.create.l HWIO_QFPROM_CORR_CALIB_ROW1_LSB_ADDR A:0x5c0d8
y.create.l HWIO_QFPROM_CORR_CALIB_ROW1_MSB_ADDR A:0x5c0dc
y.create.l HWIO_QFPROM_CORR_CALIB_ROW2_LSB_ADDR A:0x5c0e0
y.create.l HWIO_QFPROM_CORR_CALIB_ROW2_MSB_ADDR A:0x5c0e4
y.create.l HWIO_QFPROM_CORR_CALIB_ROW3_LSB_ADDR A:0x5c0e8
y.create.l HWIO_QFPROM_CORR_CALIB_ROW3_MSB_ADDR A:0x5c0ec
y.create.l HWIO_QFPROM_CORR_MEM_CONFIG_ROW0_LSB_ADDR A:0x5c0f0
y.create.l HWIO_QFPROM_CORR_MEM_CONFIG_ROW1_LSB_ADDR A:0x5c0f8
y.create.l HWIO_QFPROM_CORR_MEM_CONFIG_ROW2_LSB_ADDR A:0x5c100
y.create.l HWIO_QFPROM_CORR_MEM_CONFIG_ROW3_LSB_ADDR A:0x5c108
y.create.l HWIO_QFPROM_CORR_MEM_CONFIG_ROW0_MSB_ADDR A:0x5c0f4
y.create.l HWIO_QFPROM_CORR_MEM_CONFIG_ROW1_MSB_ADDR A:0x5c0fc
y.create.l HWIO_QFPROM_CORR_MEM_CONFIG_ROW2_MSB_ADDR A:0x5c104
y.create.l HWIO_QFPROM_CORR_MEM_CONFIG_ROW3_MSB_ADDR A:0x5c10c
y.create.l HWIO_QFPROM_CORR_MEM_CONFIG_ROW4_LSB_ADDR A:0x5c110
y.create.l HWIO_QFPROM_CORR_MEM_CONFIG_ROW4_MSB_ADDR A:0x5c114
y.create.l HWIO_QFPROM_CORR_ROM_PATCH_ADDR_ROW0_LSB_ADDR A:0x5c118
y.create.l HWIO_QFPROM_CORR_ROM_PATCH_ADDR_ROW1_LSB_ADDR A:0x5c120
y.create.l HWIO_QFPROM_CORR_ROM_PATCH_ADDR_ROW2_LSB_ADDR A:0x5c128
y.create.l HWIO_QFPROM_CORR_ROM_PATCH_ADDR_ROW3_LSB_ADDR A:0x5c130
y.create.l HWIO_QFPROM_CORR_ROM_PATCH_ADDR_ROW4_LSB_ADDR A:0x5c138
y.create.l HWIO_QFPROM_CORR_ROM_PATCH_ADDR_ROW5_LSB_ADDR A:0x5c140
y.create.l HWIO_QFPROM_CORR_ROM_PATCH_ADDR_ROW6_LSB_ADDR A:0x5c148
y.create.l HWIO_QFPROM_CORR_ROM_PATCH_ADDR_ROW0_MSB_ADDR A:0x5c11c
y.create.l HWIO_QFPROM_CORR_ROM_PATCH_ADDR_ROW1_MSB_ADDR A:0x5c124
y.create.l HWIO_QFPROM_CORR_ROM_PATCH_ADDR_ROW2_MSB_ADDR A:0x5c12c
y.create.l HWIO_QFPROM_CORR_ROM_PATCH_ADDR_ROW3_MSB_ADDR A:0x5c134
y.create.l HWIO_QFPROM_CORR_ROM_PATCH_ADDR_ROW4_MSB_ADDR A:0x5c13c
y.create.l HWIO_QFPROM_CORR_ROM_PATCH_ADDR_ROW5_MSB_ADDR A:0x5c144
y.create.l HWIO_QFPROM_CORR_ROM_PATCH_ADDR_ROW6_MSB_ADDR A:0x5c14c
y.create.l HWIO_QFPROM_CORR_ROM_PATCH_ADDR_ROW7_LSB_ADDR A:0x5c150
y.create.l HWIO_QFPROM_CORR_ROM_PATCH_ADDR_ROW7_MSB_ADDR A:0x5c154
y.create.l HWIO_QFPROM_CORR_ROM_PATCH_DATA_ROW0_LSB_ADDR A:0x5c158
y.create.l HWIO_QFPROM_CORR_ROM_PATCH_DATA_ROW1_LSB_ADDR A:0x5c160
y.create.l HWIO_QFPROM_CORR_ROM_PATCH_DATA_ROW2_LSB_ADDR A:0x5c168
y.create.l HWIO_QFPROM_CORR_ROM_PATCH_DATA_ROW3_LSB_ADDR A:0x5c170
y.create.l HWIO_QFPROM_CORR_ROM_PATCH_DATA_ROW4_LSB_ADDR A:0x5c178
y.create.l HWIO_QFPROM_CORR_ROM_PATCH_DATA_ROW5_LSB_ADDR A:0x5c180
y.create.l HWIO_QFPROM_CORR_ROM_PATCH_DATA_ROW6_LSB_ADDR A:0x5c188
y.create.l HWIO_QFPROM_CORR_ROM_PATCH_DATA_ROW7_LSB_ADDR A:0x5c190
y.create.l HWIO_QFPROM_CORR_ROM_PATCH_DATA_ROW8_LSB_ADDR A:0x5c198
y.create.l HWIO_QFPROM_CORR_ROM_PATCH_DATA_ROW9_LSB_ADDR A:0x5c1a0
y.create.l HWIO_QFPROM_CORR_ROM_PATCH_DATA_ROW0_MSB_ADDR A:0x5c15c
y.create.l HWIO_QFPROM_CORR_ROM_PATCH_DATA_ROW1_MSB_ADDR A:0x5c164
y.create.l HWIO_QFPROM_CORR_ROM_PATCH_DATA_ROW2_MSB_ADDR A:0x5c16c
y.create.l HWIO_QFPROM_CORR_ROM_PATCH_DATA_ROW3_MSB_ADDR A:0x5c174
y.create.l HWIO_QFPROM_CORR_ROM_PATCH_DATA_ROW4_MSB_ADDR A:0x5c17c
y.create.l HWIO_QFPROM_CORR_ROM_PATCH_DATA_ROW5_MSB_ADDR A:0x5c184
y.create.l HWIO_QFPROM_CORR_ROM_PATCH_DATA_ROW6_MSB_ADDR A:0x5c18c
y.create.l HWIO_QFPROM_CORR_ROM_PATCH_DATA_ROW7_MSB_ADDR A:0x5c194
y.create.l HWIO_QFPROM_CORR_ROM_PATCH_DATA_ROW8_MSB_ADDR A:0x5c19c
y.create.l HWIO_QFPROM_CORR_ROM_PATCH_DATA_ROW9_MSB_ADDR A:0x5c1a4
y.create.l HWIO_QFPROM_CORR_ROM_PATCH_EN_LSB_ADDR A:0x5c1d0
y.create.l HWIO_QFPROM_CORR_ROM_PATCH_EN_MSB_ADDR A:0x5c1d4
y.create.l HWIO_QFPROM_CORR_SPARE_REG15_LSB_ADDR A:0x5c1d8
y.create.l HWIO_QFPROM_CORR_SPARE_REG15_MSB_ADDR A:0x5c1dc
y.create.l HWIO_QFPROM_CORR_SPARE_REG16_LSB_ADDR A:0x5c1e0
y.create.l HWIO_QFPROM_CORR_SPARE_REG16_MSB_ADDR A:0x5c1e4
y.create.l HWIO_QFPROM_CORR_SPARE_REG17_LSB_ADDR A:0x5c1e8
y.create.l HWIO_QFPROM_CORR_SPARE_REG17_MSB_ADDR A:0x5c1ec
y.create.l HWIO_QFPROM_CORR_SPARE_REG18_LSB_ADDR A:0x5c1f0
y.create.l HWIO_QFPROM_CORR_SPARE_REG18_MSB_ADDR A:0x5c1f4
y.create.l HWIO_QFPROM_CORR_SPARE_REG19_LSB_ADDR A:0x5c1f8
y.create.l HWIO_QFPROM_CORR_SPARE_REG19_MSB_ADDR A:0x5c1fc
y.create.l HWIO_QFPROM_CORR_ACC_PRIVATE0_ADDR A:0x5c200
y.create.l HWIO_QFPROM_CORR_ACC_PRIVATE1_ADDR A:0x5c204
y.create.l HWIO_QFPROM_CORR_ACC_PRIVATE2_ADDR A:0x5c208
y.create.l HWIO_QFPROM_CORR_ACC_PRIVATE3_ADDR A:0x5c20c
y.create.l HWIO_QFPROM_CORR_ACC_PRIVATE4_ADDR A:0x5c210
y.create.l HWIO_QFPROM_CORR_ACC_PRIVATE5_ADDR A:0x5c214
y.create.l HWIO_QFPROM_CORR_ACC_PRIVATE6_ADDR A:0x5c218
y.create.l HWIO_QFPROM_CORR_ACC_PRIVATE7_ADDR A:0x5c21c
y.create.l HWIO_QFPROM_CORR_ACC_PRIVATE8_ADDR A:0x5c220
y.create.l HWIO_QFPROM_CORR_ACC_PRIVATE9_ADDR A:0x5c224
y.create.l HWIO_SEC_CTRL_HW_VERSION_ADDR A:0x5e000
y.create.l HWIO_FEATURE_CONFIG0_ADDR A:0x5e004
y.create.l HWIO_FEATURE_CONFIG1_ADDR A:0x5e008
y.create.l HWIO_FEATURE_CONFIG2_ADDR A:0x5e00c
y.create.l HWIO_FEATURE_CONFIG3_ADDR A:0x5e010
y.create.l HWIO_FEATURE_CONFIG4_ADDR A:0x5e014
y.create.l HWIO_FEATURE_CONFIG5_ADDR A:0x5e018
y.create.l HWIO_OEM_CONFIG0_ADDR A:0x5e01c
y.create.l HWIO_OEM_CONFIG1_ADDR A:0x5e020
y.create.l HWIO_OEM_CONFIG2_ADDR A:0x5e024
y.create.l HWIO_OEM_CONFIG3_ADDR A:0x5e028
y.create.l HWIO_BOOT_CONFIG_ADDR A:0x5e02c
y.create.l HWIO_SECURE_BOOT1_ADDR A:0x5e034
y.create.l HWIO_SECURE_BOOT2_ADDR A:0x5e038
y.create.l HWIO_SECURE_BOOT3_ADDR A:0x5e03c
y.create.l HWIO_SECURE_BOOT4_ADDR A:0x5e040
y.create.l HWIO_SECURE_BOOT5_ADDR A:0x5e044
y.create.l HWIO_SECURE_BOOT6_ADDR A:0x5e048
y.create.l HWIO_SECURE_BOOT7_ADDR A:0x5e04c
y.create.l HWIO_OVERRIDE_0_ADDR A:0x5e058
y.create.l HWIO_OVERRIDE_1_ADDR A:0x5e05c
y.create.l HWIO_OVERRIDE_2_ADDR A:0x5e060
y.create.l HWIO_OVERRIDE_3_ADDR A:0x5e064
y.create.l HWIO_OVERRIDE_4_ADDR A:0x5e068
y.create.l HWIO_CAPT_SEC_GPIO_ADDR A:0x5e06c
y.create.l HWIO_APP_PROC_CFG_ADDR A:0x5e070
y.create.l HWIO_MSS_PROC_CFG_ADDR A:0x5e074
y.create.l HWIO_QFPROM_CLK_CTL_ADDR A:0x5e078
y.create.l HWIO_JTAG_ID_ADDR A:0x5e07c
y.create.l HWIO_OEM_ID_ADDR A:0x5e080
y.create.l HWIO_TEST_BUS_SEL_ADDR A:0x5e084
y.create.l HWIO_SPDM_DYN_SECURE_MODE_ADDR A:0x5e088
y.create.l HWIO_SEC_CTRL_APU_XPU_SCR_ADDR A:0x5f000
y.create.l HWIO_SEC_CTRL_APU_XPU_SWDR_ADDR A:0x5f004
y.create.l HWIO_SEC_CTRL_APU_XPU_SEAR0_ADDR A:0x5f040
y.create.l HWIO_SEC_CTRL_APU_XPU_SESR_ADDR A:0x5f048
y.create.l HWIO_SEC_CTRL_APU_XPU_SESRRESTORE_ADDR A:0x5f04c
y.create.l HWIO_SEC_CTRL_APU_XPU_SESYNR0_ADDR A:0x5f050
y.create.l HWIO_SEC_CTRL_APU_XPU_SESYNR1_ADDR A:0x5f054
y.create.l HWIO_SEC_CTRL_APU_XPU_SESYNR2_ADDR A:0x5f058
y.create.l HWIO_SEC_CTRL_APU_XPU_MCR_ADDR A:0x5f100
y.create.l HWIO_SEC_CTRL_APU_XPU_MEAR0_ADDR A:0x5f140
y.create.l HWIO_SEC_CTRL_APU_XPU_MESR_ADDR A:0x5f148
y.create.l HWIO_SEC_CTRL_APU_XPU_MESRRESTORE_ADDR A:0x5f14c
y.create.l HWIO_SEC_CTRL_APU_XPU_MESYNR0_ADDR A:0x5f150
y.create.l HWIO_SEC_CTRL_APU_XPU_MESYNR1_ADDR A:0x5f154
y.create.l HWIO_SEC_CTRL_APU_XPU_MESYNR2_ADDR A:0x5f158
y.create.l HWIO_SEC_CTRL_APU_XPU_CR_ADDR A:0x5f080
y.create.l HWIO_SEC_CTRL_APU_XPU_RPU_ACR0_ADDR A:0x5f0a0
y.create.l HWIO_SEC_CTRL_APU_XPU_EAR0_ADDR A:0x5f0c0
y.create.l HWIO_SEC_CTRL_APU_XPU_ESR_ADDR A:0x5f0c8
y.create.l HWIO_SEC_CTRL_APU_XPU_ESRRESTORE_ADDR A:0x5f0cc
y.create.l HWIO_SEC_CTRL_APU_XPU_ESYNR0_ADDR A:0x5f0d0
y.create.l HWIO_SEC_CTRL_APU_XPU_ESYNR1_ADDR A:0x5f0d4
y.create.l HWIO_SEC_CTRL_APU_XPU_ESYNR2_ADDR A:0x5f0d8
y.create.l HWIO_SEC_CTRL_APU_XPU_IDR0_ADDR A:0x5f074
y.create.l HWIO_SEC_CTRL_APU_XPU_IDR1_ADDR A:0x5f078
y.create.l HWIO_SEC_CTRL_APU_XPU_REV_ADDR A:0x5f07c
y.create.l HWIO_SEC_CTRL_APU_XPU_RG0_RACR0_ADDR A:0x5f200
y.create.l HWIO_SEC_CTRL_APU_XPU_RG1_RACR0_ADDR A:0x5f280
y.create.l HWIO_SEC_CTRL_APU_XPU_RG2_RACR0_ADDR A:0x5f300
y.create.l HWIO_SEC_CTRL_APU_XPU_RG3_RACR0_ADDR A:0x5f380
y.create.l HWIO_SEC_CTRL_APU_XPU_RG4_RACR0_ADDR A:0x5f400
y.create.l HWIO_SEC_CTRL_APU_XPU_RG5_RACR0_ADDR A:0x5f480
y.create.l HWIO_SEC_CTRL_APU_XPU_RG6_RACR0_ADDR A:0x5f500
y.create.l HWIO_SEC_CTRL_APU_XPU_RG7_RACR0_ADDR A:0x5f580
y.create.l HWIO_SEC_CTRL_APU_XPU_RG8_RACR0_ADDR A:0x5f600
y.create.l HWIO_SEC_CTRL_APU_XPU_RG9_RACR0_ADDR A:0x5f680
y.create.l HWIO_SEC_CTRL_APU_XPU_RG0_WACR0_ADDR A:0x5f220
y.create.l HWIO_SEC_CTRL_APU_XPU_RG1_WACR0_ADDR A:0x5f2a0
y.create.l HWIO_SEC_CTRL_APU_XPU_RG2_WACR0_ADDR A:0x5f320
y.create.l HWIO_SEC_CTRL_APU_XPU_RG3_WACR0_ADDR A:0x5f3a0
y.create.l HWIO_SEC_CTRL_APU_XPU_RG4_WACR0_ADDR A:0x5f420
y.create.l HWIO_SEC_CTRL_APU_XPU_RG5_WACR0_ADDR A:0x5f4a0
y.create.l HWIO_SEC_CTRL_APU_XPU_RG6_WACR0_ADDR A:0x5f520
y.create.l HWIO_SEC_CTRL_APU_XPU_RG7_WACR0_ADDR A:0x5f5a0
y.create.l HWIO_SEC_CTRL_APU_XPU_RG8_WACR0_ADDR A:0x5f620
y.create.l HWIO_SEC_CTRL_APU_XPU_RG9_WACR0_ADDR A:0x5f6a0
y.create.l HWIO_SEC_CTRL_APU_XPU_RG0_SCR_ADDR A:0x5f250
y.create.l HWIO_SEC_CTRL_APU_XPU_RG1_SCR_ADDR A:0x5f2d0
y.create.l HWIO_SEC_CTRL_APU_XPU_RG2_SCR_ADDR A:0x5f350
y.create.l HWIO_SEC_CTRL_APU_XPU_RG3_SCR_ADDR A:0x5f3d0
y.create.l HWIO_SEC_CTRL_APU_XPU_RG4_SCR_ADDR A:0x5f450
y.create.l HWIO_SEC_CTRL_APU_XPU_RG5_SCR_ADDR A:0x5f4d0
y.create.l HWIO_SEC_CTRL_APU_XPU_RG6_SCR_ADDR A:0x5f550
y.create.l HWIO_SEC_CTRL_APU_XPU_RG7_SCR_ADDR A:0x5f5d0
y.create.l HWIO_SEC_CTRL_APU_XPU_RG8_SCR_ADDR A:0x5f650
y.create.l HWIO_SEC_CTRL_APU_XPU_RG9_SCR_ADDR A:0x5f6d0
y.create.l HWIO_SEC_CTRL_APU_XPU_RG0_MCR_ADDR A:0x5f254
y.create.l HWIO_SEC_CTRL_APU_XPU_RG1_MCR_ADDR A:0x5f2d4
y.create.l HWIO_SEC_CTRL_APU_XPU_RG2_MCR_ADDR A:0x5f354
y.create.l HWIO_SEC_CTRL_APU_XPU_RG3_MCR_ADDR A:0x5f3d4
y.create.l HWIO_SEC_CTRL_APU_XPU_RG4_MCR_ADDR A:0x5f454
y.create.l HWIO_SEC_CTRL_APU_XPU_RG5_MCR_ADDR A:0x5f4d4
y.create.l HWIO_SEC_CTRL_APU_XPU_RG6_MCR_ADDR A:0x5f554
y.create.l HWIO_SEC_CTRL_APU_XPU_RG7_MCR_ADDR A:0x5f5d4
y.create.l HWIO_SEC_CTRL_APU_XPU_RG8_MCR_ADDR A:0x5f654
y.create.l HWIO_SEC_CTRL_APU_XPU_RG9_MCR_ADDR A:0x5f6d4
y.create.l HWIO_TCU_XPU_SCR_TCU_ADDR A:0x34000
y.create.l HWIO_TCU_XPU_SWDR_TCU_ADDR A:0x34004
y.create.l HWIO_TCU_XPU_PRTN_RACR_SSHADOW_TCU_ADDR A:0x34008
y.create.l HWIO_TCU_XPU_PRTN_WACR_SSHADOW_TCU_ADDR A:0x3400c
y.create.l HWIO_TCU_XPU_PRTN_START_SSHADOW0_TCU_ADDR A:0x34010
y.create.l HWIO_TCU_XPU_PRTN_END_SSHADOW0_TCU_ADDR A:0x34018
y.create.l HWIO_TCU_XPU_SEAR0_TCU_ADDR A:0x34040
y.create.l HWIO_TCU_XPU_SESR_TCU_ADDR A:0x34048
y.create.l HWIO_TCU_XPU_SESRRESTORE_TCU_ADDR A:0x3404c
y.create.l HWIO_TCU_XPU_SESYNR0_TCU_ADDR A:0x34050
y.create.l HWIO_TCU_XPU_SESYNR1_TCU_ADDR A:0x34054
y.create.l HWIO_TCU_XPU_SESYNR2_TCU_ADDR A:0x34058
y.create.l HWIO_TCU_XPU_MCR_TCU_ADDR A:0x34100
y.create.l HWIO_TCU_XPU_MEAR0_TCU_ADDR A:0x34140
y.create.l HWIO_TCU_XPU_MESR_TCU_ADDR A:0x34148
y.create.l HWIO_TCU_XPU_MESRRESTORE_TCU_ADDR A:0x3414c
y.create.l HWIO_TCU_XPU_MESYNR0_TCU_ADDR A:0x34150
y.create.l HWIO_TCU_XPU_MESYNR1_TCU_ADDR A:0x34154
y.create.l HWIO_TCU_XPU_MESYNR2_TCU_ADDR A:0x34158
y.create.l HWIO_TCU_XPU_CR_TCU_ADDR A:0x34080
y.create.l HWIO_TCU_XPU_PRTN_RACR_SHADOW_TCU_ADDR A:0x34088
y.create.l HWIO_TCU_XPU_PRTN_WACR_SHADOW_TCU_ADDR A:0x3408c
y.create.l HWIO_TCU_XPU_PRTN_START_SHADOW0_TCU_ADDR A:0x34090
y.create.l HWIO_TCU_XPU_PRTN_END_SHADOW0_TCU_ADDR A:0x34098
y.create.l HWIO_TCU_XPU_RPU_ACR0_TCU_ADDR A:0x340a0
y.create.l HWIO_TCU_XPU_EAR0_TCU_ADDR A:0x340c0
y.create.l HWIO_TCU_XPU_ESR_TCU_ADDR A:0x340c8
y.create.l HWIO_TCU_XPU_ESRRESTORE_TCU_ADDR A:0x340cc
y.create.l HWIO_TCU_XPU_ESYNR0_TCU_ADDR A:0x340d0
y.create.l HWIO_TCU_XPU_ESYNR1_TCU_ADDR A:0x340d4
y.create.l HWIO_TCU_XPU_ESYNR2_TCU_ADDR A:0x340d8
y.create.l HWIO_TCU_XPU_UMR_RACR_TCU_ADDR A:0x340e0
y.create.l HWIO_TCU_XPU_UMR_WACR_TCU_ADDR A:0x340e4
y.create.l HWIO_TCU_XPU_UMR_CNTL_TCU_ADDR A:0x340f0
y.create.l HWIO_TCU_XPU_IDR0_TCU_ADDR A:0x34074
y.create.l HWIO_TCU_XPU_IDR1_TCU_ADDR A:0x34078
y.create.l HWIO_TCU_XPU_REV_TCU_ADDR A:0x3407c
y.create.l HWIO_TCU_XPU_PRT0_RACR0_TCU_ADDR A:0x34200
y.create.l HWIO_TCU_XPU_PRT1_RACR0_TCU_ADDR A:0x34280
y.create.l HWIO_TCU_XPU_PRT2_RACR0_TCU_ADDR A:0x34300
y.create.l HWIO_TCU_XPU_PRT3_RACR0_TCU_ADDR A:0x34380
y.create.l HWIO_TCU_XPU_PRT4_RACR0_TCU_ADDR A:0x34400
y.create.l HWIO_TCU_XPU_PRT5_RACR0_TCU_ADDR A:0x34480
y.create.l HWIO_TCU_XPU_PRT6_RACR0_TCU_ADDR A:0x34500
y.create.l HWIO_TCU_XPU_PRT7_RACR0_TCU_ADDR A:0x34580
y.create.l HWIO_TCU_XPU_PRT8_RACR0_TCU_ADDR A:0x34600
y.create.l HWIO_TCU_XPU_PRT9_RACR0_TCU_ADDR A:0x34680
y.create.l HWIO_TCU_XPU_PRT0_WACR0_TCU_ADDR A:0x34220
y.create.l HWIO_TCU_XPU_PRT1_WACR0_TCU_ADDR A:0x342a0
y.create.l HWIO_TCU_XPU_PRT2_WACR0_TCU_ADDR A:0x34320
y.create.l HWIO_TCU_XPU_PRT3_WACR0_TCU_ADDR A:0x343a0
y.create.l HWIO_TCU_XPU_PRT4_WACR0_TCU_ADDR A:0x34420
y.create.l HWIO_TCU_XPU_PRT5_WACR0_TCU_ADDR A:0x344a0
y.create.l HWIO_TCU_XPU_PRT6_WACR0_TCU_ADDR A:0x34520
y.create.l HWIO_TCU_XPU_PRT7_WACR0_TCU_ADDR A:0x345a0
y.create.l HWIO_TCU_XPU_PRT8_WACR0_TCU_ADDR A:0x34620
y.create.l HWIO_TCU_XPU_PRT9_WACR0_TCU_ADDR A:0x346a0
y.create.l HWIO_TCU_XPU_PRT0_START0_TCU_ADDR A:0x34240
y.create.l HWIO_TCU_XPU_PRT1_START0_TCU_ADDR A:0x342c0
y.create.l HWIO_TCU_XPU_PRT2_START0_TCU_ADDR A:0x34340
y.create.l HWIO_TCU_XPU_PRT3_START0_TCU_ADDR A:0x343c0
y.create.l HWIO_TCU_XPU_PRT4_START0_TCU_ADDR A:0x34440
y.create.l HWIO_TCU_XPU_PRT5_START0_TCU_ADDR A:0x344c0
y.create.l HWIO_TCU_XPU_PRT6_START0_TCU_ADDR A:0x34540
y.create.l HWIO_TCU_XPU_PRT7_START0_TCU_ADDR A:0x345c0
y.create.l HWIO_TCU_XPU_PRT8_START0_TCU_ADDR A:0x34640
y.create.l HWIO_TCU_XPU_PRT9_START0_TCU_ADDR A:0x346c0
y.create.l HWIO_TCU_XPU_PRT0_END0_TCU_ADDR A:0x34248
y.create.l HWIO_TCU_XPU_PRT1_END0_TCU_ADDR A:0x342c8
y.create.l HWIO_TCU_XPU_PRT2_END0_TCU_ADDR A:0x34348
y.create.l HWIO_TCU_XPU_PRT3_END0_TCU_ADDR A:0x343c8
y.create.l HWIO_TCU_XPU_PRT4_END0_TCU_ADDR A:0x34448
y.create.l HWIO_TCU_XPU_PRT5_END0_TCU_ADDR A:0x344c8
y.create.l HWIO_TCU_XPU_PRT6_END0_TCU_ADDR A:0x34548
y.create.l HWIO_TCU_XPU_PRT7_END0_TCU_ADDR A:0x345c8
y.create.l HWIO_TCU_XPU_PRT8_END0_TCU_ADDR A:0x34648
y.create.l HWIO_TCU_XPU_PRT9_END0_TCU_ADDR A:0x346c8
y.create.l HWIO_TCU_XPU_PRT0_SCR_TCU_ADDR A:0x34250
y.create.l HWIO_TCU_XPU_PRT1_SCR_TCU_ADDR A:0x342d0
y.create.l HWIO_TCU_XPU_PRT2_SCR_TCU_ADDR A:0x34350
y.create.l HWIO_TCU_XPU_PRT3_SCR_TCU_ADDR A:0x343d0
y.create.l HWIO_TCU_XPU_PRT4_SCR_TCU_ADDR A:0x34450
y.create.l HWIO_TCU_XPU_PRT5_SCR_TCU_ADDR A:0x344d0
y.create.l HWIO_TCU_XPU_PRT6_SCR_TCU_ADDR A:0x34550
y.create.l HWIO_TCU_XPU_PRT7_SCR_TCU_ADDR A:0x345d0
y.create.l HWIO_TCU_XPU_PRT8_SCR_TCU_ADDR A:0x34650
y.create.l HWIO_TCU_XPU_PRT9_SCR_TCU_ADDR A:0x346d0
y.create.l HWIO_TCU_XPU_PRT0_MCR_TCU_ADDR A:0x34254
y.create.l HWIO_TCU_XPU_PRT1_MCR_TCU_ADDR A:0x342d4
y.create.l HWIO_TCU_XPU_PRT2_MCR_TCU_ADDR A:0x34354
y.create.l HWIO_TCU_XPU_PRT3_MCR_TCU_ADDR A:0x343d4
y.create.l HWIO_TCU_XPU_PRT4_MCR_TCU_ADDR A:0x34454
y.create.l HWIO_TCU_XPU_PRT5_MCR_TCU_ADDR A:0x344d4
y.create.l HWIO_TCU_XPU_PRT6_MCR_TCU_ADDR A:0x34554
y.create.l HWIO_TCU_XPU_PRT7_MCR_TCU_ADDR A:0x345d4
y.create.l HWIO_TCU_XPU_PRT8_MCR_TCU_ADDR A:0x34654
y.create.l HWIO_TCU_XPU_PRT9_MCR_TCU_ADDR A:0x346d4
y.create.l HWIO_TCU_XPU_PRT0_CNTL0_TCU_ADDR A:0x34258
y.create.l HWIO_TCU_XPU_PRT1_CNTL0_TCU_ADDR A:0x342d8
y.create.l HWIO_TCU_XPU_PRT2_CNTL0_TCU_ADDR A:0x34358
y.create.l HWIO_TCU_XPU_PRT3_CNTL0_TCU_ADDR A:0x343d8
y.create.l HWIO_TCU_XPU_PRT4_CNTL0_TCU_ADDR A:0x34458
y.create.l HWIO_TCU_XPU_PRT5_CNTL0_TCU_ADDR A:0x344d8
y.create.l HWIO_TCU_XPU_PRT6_CNTL0_TCU_ADDR A:0x34558
y.create.l HWIO_TCU_XPU_PRT7_CNTL0_TCU_ADDR A:0x345d8
y.create.l HWIO_TCU_XPU_PRT8_CNTL0_TCU_ADDR A:0x34658
y.create.l HWIO_TCU_XPU_PRT9_CNTL0_TCU_ADDR A:0x346d8
y.create.l HWIO_TCU_XPU_PRT0_CNTL1_TCU_ADDR A:0x3425c
y.create.l HWIO_TCU_XPU_PRT1_CNTL1_TCU_ADDR A:0x342dc
y.create.l HWIO_TCU_XPU_PRT2_CNTL1_TCU_ADDR A:0x3435c
y.create.l HWIO_TCU_XPU_PRT3_CNTL1_TCU_ADDR A:0x343dc
y.create.l HWIO_TCU_XPU_PRT4_CNTL1_TCU_ADDR A:0x3445c
y.create.l HWIO_TCU_XPU_PRT5_CNTL1_TCU_ADDR A:0x344dc
y.create.l HWIO_TCU_XPU_PRT6_CNTL1_TCU_ADDR A:0x3455c
y.create.l HWIO_TCU_XPU_PRT7_CNTL1_TCU_ADDR A:0x345dc
y.create.l HWIO_TCU_XPU_PRT8_CNTL1_TCU_ADDR A:0x3465c
y.create.l HWIO_TCU_XPU_PRT9_CNTL1_TCU_ADDR A:0x346dc
y.create.l HWIO_DIME_XPU_SCR_DIME_ADDR A:0x35000
y.create.l HWIO_DIME_XPU_SWDR_DIME_ADDR A:0x35004
y.create.l HWIO_DIME_XPU_PRTN_RACR_SSHADOW_DIME_ADDR A:0x35008
y.create.l HWIO_DIME_XPU_PRTN_START_SSHADOW0_DIME_ADDR A:0x35010
y.create.l HWIO_DIME_XPU_PRTN_END_SSHADOW0_DIME_ADDR A:0x35018
y.create.l HWIO_DIME_XPU_SEAR0_DIME_ADDR A:0x35040
y.create.l HWIO_DIME_XPU_SESR_DIME_ADDR A:0x35048
y.create.l HWIO_DIME_XPU_SESRRESTORE_DIME_ADDR A:0x3504c
y.create.l HWIO_DIME_XPU_SESYNR0_DIME_ADDR A:0x35050
y.create.l HWIO_DIME_XPU_SESYNR1_DIME_ADDR A:0x35054
y.create.l HWIO_DIME_XPU_SESYNR2_DIME_ADDR A:0x35058
y.create.l HWIO_DIME_XPU_MCR_DIME_ADDR A:0x35100
y.create.l HWIO_DIME_XPU_MEAR0_DIME_ADDR A:0x35140
y.create.l HWIO_DIME_XPU_MESR_DIME_ADDR A:0x35148
y.create.l HWIO_DIME_XPU_MESRRESTORE_DIME_ADDR A:0x3514c
y.create.l HWIO_DIME_XPU_MESYNR0_DIME_ADDR A:0x35150
y.create.l HWIO_DIME_XPU_MESYNR1_DIME_ADDR A:0x35154
y.create.l HWIO_DIME_XPU_MESYNR2_DIME_ADDR A:0x35158
y.create.l HWIO_DIME_XPU_CR_DIME_ADDR A:0x35080
y.create.l HWIO_DIME_XPU_PRTN_RACR_SHADOW_DIME_ADDR A:0x35088
y.create.l HWIO_DIME_XPU_PRTN_START_SHADOW0_DIME_ADDR A:0x35090
y.create.l HWIO_DIME_XPU_PRTN_END_SHADOW0_DIME_ADDR A:0x35098
y.create.l HWIO_DIME_XPU_RPU_ACR0_DIME_ADDR A:0x350a0
y.create.l HWIO_DIME_XPU_EAR0_DIME_ADDR A:0x350c0
y.create.l HWIO_DIME_XPU_ESR_DIME_ADDR A:0x350c8
y.create.l HWIO_DIME_XPU_ESRRESTORE_DIME_ADDR A:0x350cc
y.create.l HWIO_DIME_XPU_ESYNR0_DIME_ADDR A:0x350d0
y.create.l HWIO_DIME_XPU_ESYNR1_DIME_ADDR A:0x350d4
y.create.l HWIO_DIME_XPU_ESYNR2_DIME_ADDR A:0x350d8
y.create.l HWIO_DIME_XPU_UMR_RACR_DIME_ADDR A:0x350e0
y.create.l HWIO_DIME_XPU_UMR_WACR_DIME_ADDR A:0x350e4
y.create.l HWIO_DIME_XPU_UMR_CNTL_DIME_ADDR A:0x350f0
y.create.l HWIO_DIME_XPU_IDR0_DIME_ADDR A:0x35074
y.create.l HWIO_DIME_XPU_IDR1_DIME_ADDR A:0x35078
y.create.l HWIO_DIME_XPU_REV_DIME_ADDR A:0x3507c
y.create.l HWIO_DIME_XPU_PRT0_RACR0_DIME_ADDR A:0x35200
y.create.l HWIO_DIME_XPU_PRT1_RACR0_DIME_ADDR A:0x35280
y.create.l HWIO_DIME_XPU_PRT2_RACR0_DIME_ADDR A:0x35300
y.create.l HWIO_DIME_XPU_PRT3_RACR0_DIME_ADDR A:0x35380
y.create.l HWIO_DIME_XPU_PRT4_RACR0_DIME_ADDR A:0x35400
y.create.l HWIO_DIME_XPU_PRT5_RACR0_DIME_ADDR A:0x35480
y.create.l HWIO_DIME_XPU_PRT6_RACR0_DIME_ADDR A:0x35500
y.create.l HWIO_DIME_XPU_PRT7_RACR0_DIME_ADDR A:0x35580
y.create.l HWIO_DIME_XPU_PRT8_RACR0_DIME_ADDR A:0x35600
y.create.l HWIO_DIME_XPU_PRT9_RACR0_DIME_ADDR A:0x35680
y.create.l HWIO_DIME_XPU_PRT0_START0_DIME_ADDR A:0x35240
y.create.l HWIO_DIME_XPU_PRT1_START0_DIME_ADDR A:0x352c0
y.create.l HWIO_DIME_XPU_PRT2_START0_DIME_ADDR A:0x35340
y.create.l HWIO_DIME_XPU_PRT3_START0_DIME_ADDR A:0x353c0
y.create.l HWIO_DIME_XPU_PRT4_START0_DIME_ADDR A:0x35440
y.create.l HWIO_DIME_XPU_PRT5_START0_DIME_ADDR A:0x354c0
y.create.l HWIO_DIME_XPU_PRT6_START0_DIME_ADDR A:0x35540
y.create.l HWIO_DIME_XPU_PRT7_START0_DIME_ADDR A:0x355c0
y.create.l HWIO_DIME_XPU_PRT8_START0_DIME_ADDR A:0x35640
y.create.l HWIO_DIME_XPU_PRT9_START0_DIME_ADDR A:0x356c0
y.create.l HWIO_DIME_XPU_PRT0_END0_DIME_ADDR A:0x35248
y.create.l HWIO_DIME_XPU_PRT1_END0_DIME_ADDR A:0x352c8
y.create.l HWIO_DIME_XPU_PRT2_END0_DIME_ADDR A:0x35348
y.create.l HWIO_DIME_XPU_PRT3_END0_DIME_ADDR A:0x353c8
y.create.l HWIO_DIME_XPU_PRT4_END0_DIME_ADDR A:0x35448
y.create.l HWIO_DIME_XPU_PRT5_END0_DIME_ADDR A:0x354c8
y.create.l HWIO_DIME_XPU_PRT6_END0_DIME_ADDR A:0x35548
y.create.l HWIO_DIME_XPU_PRT7_END0_DIME_ADDR A:0x355c8
y.create.l HWIO_DIME_XPU_PRT8_END0_DIME_ADDR A:0x35648
y.create.l HWIO_DIME_XPU_PRT9_END0_DIME_ADDR A:0x356c8
y.create.l HWIO_DIME_XPU_PRT0_SCR_DIME_ADDR A:0x35250
y.create.l HWIO_DIME_XPU_PRT1_SCR_DIME_ADDR A:0x352d0
y.create.l HWIO_DIME_XPU_PRT2_SCR_DIME_ADDR A:0x35350
y.create.l HWIO_DIME_XPU_PRT3_SCR_DIME_ADDR A:0x353d0
y.create.l HWIO_DIME_XPU_PRT4_SCR_DIME_ADDR A:0x35450
y.create.l HWIO_DIME_XPU_PRT5_SCR_DIME_ADDR A:0x354d0
y.create.l HWIO_DIME_XPU_PRT6_SCR_DIME_ADDR A:0x35550
y.create.l HWIO_DIME_XPU_PRT7_SCR_DIME_ADDR A:0x355d0
y.create.l HWIO_DIME_XPU_PRT8_SCR_DIME_ADDR A:0x35650
y.create.l HWIO_DIME_XPU_PRT9_SCR_DIME_ADDR A:0x356d0
y.create.l HWIO_DIME_XPU_PRT0_MCR_DIME_ADDR A:0x35254
y.create.l HWIO_DIME_XPU_PRT1_MCR_DIME_ADDR A:0x352d4
y.create.l HWIO_DIME_XPU_PRT2_MCR_DIME_ADDR A:0x35354
y.create.l HWIO_DIME_XPU_PRT3_MCR_DIME_ADDR A:0x353d4
y.create.l HWIO_DIME_XPU_PRT4_MCR_DIME_ADDR A:0x35454
y.create.l HWIO_DIME_XPU_PRT5_MCR_DIME_ADDR A:0x354d4
y.create.l HWIO_DIME_XPU_PRT6_MCR_DIME_ADDR A:0x35554
y.create.l HWIO_DIME_XPU_PRT7_MCR_DIME_ADDR A:0x355d4
y.create.l HWIO_DIME_XPU_PRT8_MCR_DIME_ADDR A:0x35654
y.create.l HWIO_DIME_XPU_PRT9_MCR_DIME_ADDR A:0x356d4
y.create.l HWIO_DIME_XPU_PRT0_CNTL0_DIME_ADDR A:0x35258
y.create.l HWIO_DIME_XPU_PRT1_CNTL0_DIME_ADDR A:0x352d8
y.create.l HWIO_DIME_XPU_PRT2_CNTL0_DIME_ADDR A:0x35358
y.create.l HWIO_DIME_XPU_PRT3_CNTL0_DIME_ADDR A:0x353d8
y.create.l HWIO_DIME_XPU_PRT4_CNTL0_DIME_ADDR A:0x35458
y.create.l HWIO_DIME_XPU_PRT5_CNTL0_DIME_ADDR A:0x354d8
y.create.l HWIO_DIME_XPU_PRT6_CNTL0_DIME_ADDR A:0x35558
y.create.l HWIO_DIME_XPU_PRT7_CNTL0_DIME_ADDR A:0x355d8
y.create.l HWIO_DIME_XPU_PRT8_CNTL0_DIME_ADDR A:0x35658
y.create.l HWIO_DIME_XPU_PRT9_CNTL0_DIME_ADDR A:0x356d8
y.create.l HWIO_DIME_XPU_PRT0_CNTL1_DIME_ADDR A:0x3525c
y.create.l HWIO_DIME_XPU_PRT1_CNTL1_DIME_ADDR A:0x352dc
y.create.l HWIO_DIME_XPU_PRT2_CNTL1_DIME_ADDR A:0x3535c
y.create.l HWIO_DIME_XPU_PRT3_CNTL1_DIME_ADDR A:0x353dc
y.create.l HWIO_DIME_XPU_PRT4_CNTL1_DIME_ADDR A:0x3545c
y.create.l HWIO_DIME_XPU_PRT5_CNTL1_DIME_ADDR A:0x354dc
y.create.l HWIO_DIME_XPU_PRT6_CNTL1_DIME_ADDR A:0x3555c
y.create.l HWIO_DIME_XPU_PRT7_CNTL1_DIME_ADDR A:0x355dc
y.create.l HWIO_DIME_XPU_PRT8_CNTL1_DIME_ADDR A:0x3565c
y.create.l HWIO_DIME_XPU_PRT9_CNTL1_DIME_ADDR A:0x356dc
y.create.l HWIO_GPS_XPU_SCR_GPS_ADDR A:0x36000
y.create.l HWIO_GPS_XPU_SWDR_GPS_ADDR A:0x36004
y.create.l HWIO_GPS_XPU_PRTN_RACR_SSHADOW_GPS_ADDR A:0x36008
y.create.l HWIO_GPS_XPU_PRTN_START_SSHADOW0_GPS_ADDR A:0x36010
y.create.l HWIO_GPS_XPU_PRTN_END_SSHADOW0_GPS_ADDR A:0x36018
y.create.l HWIO_GPS_XPU_SEAR0_GPS_ADDR A:0x36040
y.create.l HWIO_GPS_XPU_SESR_GPS_ADDR A:0x36048
y.create.l HWIO_GPS_XPU_SESRRESTORE_GPS_ADDR A:0x3604c
y.create.l HWIO_GPS_XPU_SESYNR0_GPS_ADDR A:0x36050
y.create.l HWIO_GPS_XPU_SESYNR1_GPS_ADDR A:0x36054
y.create.l HWIO_GPS_XPU_SESYNR2_GPS_ADDR A:0x36058
y.create.l HWIO_GPS_XPU_MCR_GPS_ADDR A:0x36100
y.create.l HWIO_GPS_XPU_MEAR0_GPS_ADDR A:0x36140
y.create.l HWIO_GPS_XPU_MESR_GPS_ADDR A:0x36148
y.create.l HWIO_GPS_XPU_MESRRESTORE_GPS_ADDR A:0x3614c
y.create.l HWIO_GPS_XPU_MESYNR0_GPS_ADDR A:0x36150
y.create.l HWIO_GPS_XPU_MESYNR1_GPS_ADDR A:0x36154
y.create.l HWIO_GPS_XPU_MESYNR2_GPS_ADDR A:0x36158
y.create.l HWIO_GPS_XPU_CR_GPS_ADDR A:0x36080
y.create.l HWIO_GPS_XPU_PRTN_RACR_SHADOW_GPS_ADDR A:0x36088
y.create.l HWIO_GPS_XPU_PRTN_START_SHADOW0_GPS_ADDR A:0x36090
y.create.l HWIO_GPS_XPU_PRTN_END_SHADOW0_GPS_ADDR A:0x36098
y.create.l HWIO_GPS_XPU_RPU_ACR0_GPS_ADDR A:0x360a0
y.create.l HWIO_GPS_XPU_EAR0_GPS_ADDR A:0x360c0
y.create.l HWIO_GPS_XPU_ESR_GPS_ADDR A:0x360c8
y.create.l HWIO_GPS_XPU_ESRRESTORE_GPS_ADDR A:0x360cc
y.create.l HWIO_GPS_XPU_ESYNR0_GPS_ADDR A:0x360d0
y.create.l HWIO_GPS_XPU_ESYNR1_GPS_ADDR A:0x360d4
y.create.l HWIO_GPS_XPU_ESYNR2_GPS_ADDR A:0x360d8
y.create.l HWIO_GPS_XPU_UMR_RACR_GPS_ADDR A:0x360e0
y.create.l HWIO_GPS_XPU_UMR_WACR_GPS_ADDR A:0x360e4
y.create.l HWIO_GPS_XPU_UMR_CNTL_GPS_ADDR A:0x360f0
y.create.l HWIO_GPS_XPU_IDR0_GPS_ADDR A:0x36074
y.create.l HWIO_GPS_XPU_IDR1_GPS_ADDR A:0x36078
y.create.l HWIO_GPS_XPU_REV_GPS_ADDR A:0x3607c
y.create.l HWIO_GPS_XPU_PRT0_RACR0_GPS_ADDR A:0x36200
y.create.l HWIO_GPS_XPU_PRT1_RACR0_GPS_ADDR A:0x36280
y.create.l HWIO_GPS_XPU_PRT2_RACR0_GPS_ADDR A:0x36300
y.create.l HWIO_GPS_XPU_PRT3_RACR0_GPS_ADDR A:0x36380
y.create.l HWIO_GPS_XPU_PRT4_RACR0_GPS_ADDR A:0x36400
y.create.l HWIO_GPS_XPU_PRT5_RACR0_GPS_ADDR A:0x36480
y.create.l HWIO_GPS_XPU_PRT6_RACR0_GPS_ADDR A:0x36500
y.create.l HWIO_GPS_XPU_PRT7_RACR0_GPS_ADDR A:0x36580
y.create.l HWIO_GPS_XPU_PRT8_RACR0_GPS_ADDR A:0x36600
y.create.l HWIO_GPS_XPU_PRT9_RACR0_GPS_ADDR A:0x36680
y.create.l HWIO_GPS_XPU_PRT0_START0_GPS_ADDR A:0x36240
y.create.l HWIO_GPS_XPU_PRT1_START0_GPS_ADDR A:0x362c0
y.create.l HWIO_GPS_XPU_PRT2_START0_GPS_ADDR A:0x36340
y.create.l HWIO_GPS_XPU_PRT3_START0_GPS_ADDR A:0x363c0
y.create.l HWIO_GPS_XPU_PRT4_START0_GPS_ADDR A:0x36440
y.create.l HWIO_GPS_XPU_PRT5_START0_GPS_ADDR A:0x364c0
y.create.l HWIO_GPS_XPU_PRT6_START0_GPS_ADDR A:0x36540
y.create.l HWIO_GPS_XPU_PRT7_START0_GPS_ADDR A:0x365c0
y.create.l HWIO_GPS_XPU_PRT8_START0_GPS_ADDR A:0x36640
y.create.l HWIO_GPS_XPU_PRT9_START0_GPS_ADDR A:0x366c0
y.create.l HWIO_GPS_XPU_PRT0_END0_GPS_ADDR A:0x36248
y.create.l HWIO_GPS_XPU_PRT1_END0_GPS_ADDR A:0x362c8
y.create.l HWIO_GPS_XPU_PRT2_END0_GPS_ADDR A:0x36348
y.create.l HWIO_GPS_XPU_PRT3_END0_GPS_ADDR A:0x363c8
y.create.l HWIO_GPS_XPU_PRT4_END0_GPS_ADDR A:0x36448
y.create.l HWIO_GPS_XPU_PRT5_END0_GPS_ADDR A:0x364c8
y.create.l HWIO_GPS_XPU_PRT6_END0_GPS_ADDR A:0x36548
y.create.l HWIO_GPS_XPU_PRT7_END0_GPS_ADDR A:0x365c8
y.create.l HWIO_GPS_XPU_PRT8_END0_GPS_ADDR A:0x36648
y.create.l HWIO_GPS_XPU_PRT9_END0_GPS_ADDR A:0x366c8
y.create.l HWIO_GPS_XPU_PRT0_SCR_GPS_ADDR A:0x36250
y.create.l HWIO_GPS_XPU_PRT1_SCR_GPS_ADDR A:0x362d0
y.create.l HWIO_GPS_XPU_PRT2_SCR_GPS_ADDR A:0x36350
y.create.l HWIO_GPS_XPU_PRT3_SCR_GPS_ADDR A:0x363d0
y.create.l HWIO_GPS_XPU_PRT4_SCR_GPS_ADDR A:0x36450
y.create.l HWIO_GPS_XPU_PRT5_SCR_GPS_ADDR A:0x364d0
y.create.l HWIO_GPS_XPU_PRT6_SCR_GPS_ADDR A:0x36550
y.create.l HWIO_GPS_XPU_PRT7_SCR_GPS_ADDR A:0x365d0
y.create.l HWIO_GPS_XPU_PRT8_SCR_GPS_ADDR A:0x36650
y.create.l HWIO_GPS_XPU_PRT9_SCR_GPS_ADDR A:0x366d0
y.create.l HWIO_GPS_XPU_PRT0_MCR_GPS_ADDR A:0x36254
y.create.l HWIO_GPS_XPU_PRT1_MCR_GPS_ADDR A:0x362d4
y.create.l HWIO_GPS_XPU_PRT2_MCR_GPS_ADDR A:0x36354
y.create.l HWIO_GPS_XPU_PRT3_MCR_GPS_ADDR A:0x363d4
y.create.l HWIO_GPS_XPU_PRT4_MCR_GPS_ADDR A:0x36454
y.create.l HWIO_GPS_XPU_PRT5_MCR_GPS_ADDR A:0x364d4
y.create.l HWIO_GPS_XPU_PRT6_MCR_GPS_ADDR A:0x36554
y.create.l HWIO_GPS_XPU_PRT7_MCR_GPS_ADDR A:0x365d4
y.create.l HWIO_GPS_XPU_PRT8_MCR_GPS_ADDR A:0x36654
y.create.l HWIO_GPS_XPU_PRT9_MCR_GPS_ADDR A:0x366d4
y.create.l HWIO_GPS_XPU_PRT0_CNTL0_GPS_ADDR A:0x36258
y.create.l HWIO_GPS_XPU_PRT1_CNTL0_GPS_ADDR A:0x362d8
y.create.l HWIO_GPS_XPU_PRT2_CNTL0_GPS_ADDR A:0x36358
y.create.l HWIO_GPS_XPU_PRT3_CNTL0_GPS_ADDR A:0x363d8
y.create.l HWIO_GPS_XPU_PRT4_CNTL0_GPS_ADDR A:0x36458
y.create.l HWIO_GPS_XPU_PRT5_CNTL0_GPS_ADDR A:0x364d8
y.create.l HWIO_GPS_XPU_PRT6_CNTL0_GPS_ADDR A:0x36558
y.create.l HWIO_GPS_XPU_PRT7_CNTL0_GPS_ADDR A:0x365d8
y.create.l HWIO_GPS_XPU_PRT8_CNTL0_GPS_ADDR A:0x36658
y.create.l HWIO_GPS_XPU_PRT9_CNTL0_GPS_ADDR A:0x366d8
y.create.l HWIO_GPS_XPU_PRT0_CNTL1_GPS_ADDR A:0x3625c
y.create.l HWIO_GPS_XPU_PRT1_CNTL1_GPS_ADDR A:0x362dc
y.create.l HWIO_GPS_XPU_PRT2_CNTL1_GPS_ADDR A:0x3635c
y.create.l HWIO_GPS_XPU_PRT3_CNTL1_GPS_ADDR A:0x363dc
y.create.l HWIO_GPS_XPU_PRT4_CNTL1_GPS_ADDR A:0x3645c
y.create.l HWIO_GPS_XPU_PRT5_CNTL1_GPS_ADDR A:0x364dc
y.create.l HWIO_GPS_XPU_PRT6_CNTL1_GPS_ADDR A:0x3655c
y.create.l HWIO_GPS_XPU_PRT7_CNTL1_GPS_ADDR A:0x365dc
y.create.l HWIO_GPS_XPU_PRT8_CNTL1_GPS_ADDR A:0x3665c
y.create.l HWIO_GPS_XPU_PRT9_CNTL1_GPS_ADDR A:0x366dc
y.create.l HWIO_QDSP_XPU_SCR_QDSP_ADDR A:0x37000
y.create.l HWIO_QDSP_XPU_SWDR_QDSP_ADDR A:0x37004
y.create.l HWIO_QDSP_XPU_PRTN_RACR_SSHADOW_QDSP_ADDR A:0x37008
y.create.l HWIO_QDSP_XPU_PRTN_START_SSHADOW0_QDSP_ADDR A:0x37010
y.create.l HWIO_QDSP_XPU_PRTN_END_SSHADOW0_QDSP_ADDR A:0x37018
y.create.l HWIO_QDSP_XPU_SEAR0_QDSP_ADDR A:0x37040
y.create.l HWIO_QDSP_XPU_SESR_QDSP_ADDR A:0x37048
y.create.l HWIO_QDSP_XPU_SESRRESTORE_QDSP_ADDR A:0x3704c
y.create.l HWIO_QDSP_XPU_SESYNR0_QDSP_ADDR A:0x37050
y.create.l HWIO_QDSP_XPU_SESYNR1_QDSP_ADDR A:0x37054
y.create.l HWIO_QDSP_XPU_SESYNR2_QDSP_ADDR A:0x37058
y.create.l HWIO_QDSP_XPU_MCR_QDSP_ADDR A:0x37100
y.create.l HWIO_QDSP_XPU_MEAR0_QDSP_ADDR A:0x37140
y.create.l HWIO_QDSP_XPU_MESR_QDSP_ADDR A:0x37148
y.create.l HWIO_QDSP_XPU_MESRRESTORE_QDSP_ADDR A:0x3714c
y.create.l HWIO_QDSP_XPU_MESYNR0_QDSP_ADDR A:0x37150
y.create.l HWIO_QDSP_XPU_MESYNR1_QDSP_ADDR A:0x37154
y.create.l HWIO_QDSP_XPU_MESYNR2_QDSP_ADDR A:0x37158
y.create.l HWIO_QDSP_XPU_CR_QDSP_ADDR A:0x37080
y.create.l HWIO_QDSP_XPU_PRTN_RACR_SHADOW_QDSP_ADDR A:0x37088
y.create.l HWIO_QDSP_XPU_PRTN_START_SHADOW0_QDSP_ADDR A:0x37090
y.create.l HWIO_QDSP_XPU_PRTN_END_SHADOW0_QDSP_ADDR A:0x37098
y.create.l HWIO_QDSP_XPU_RPU_ACR0_QDSP_ADDR A:0x370a0
y.create.l HWIO_QDSP_XPU_EAR0_QDSP_ADDR A:0x370c0
y.create.l HWIO_QDSP_XPU_ESR_QDSP_ADDR A:0x370c8
y.create.l HWIO_QDSP_XPU_ESRRESTORE_QDSP_ADDR A:0x370cc
y.create.l HWIO_QDSP_XPU_ESYNR0_QDSP_ADDR A:0x370d0
y.create.l HWIO_QDSP_XPU_ESYNR1_QDSP_ADDR A:0x370d4
y.create.l HWIO_QDSP_XPU_ESYNR2_QDSP_ADDR A:0x370d8
y.create.l HWIO_QDSP_XPU_UMR_RACR_QDSP_ADDR A:0x370e0
y.create.l HWIO_QDSP_XPU_UMR_WACR_QDSP_ADDR A:0x370e4
y.create.l HWIO_QDSP_XPU_UMR_CNTL_QDSP_ADDR A:0x370f0
y.create.l HWIO_QDSP_XPU_IDR0_QDSP_ADDR A:0x37074
y.create.l HWIO_QDSP_XPU_IDR1_QDSP_ADDR A:0x37078
y.create.l HWIO_QDSP_XPU_REV_QDSP_ADDR A:0x3707c
y.create.l HWIO_QDSP_XPU_PRT0_RACR0_QDSP_ADDR A:0x37200
y.create.l HWIO_QDSP_XPU_PRT1_RACR0_QDSP_ADDR A:0x37280
y.create.l HWIO_QDSP_XPU_PRT2_RACR0_QDSP_ADDR A:0x37300
y.create.l HWIO_QDSP_XPU_PRT3_RACR0_QDSP_ADDR A:0x37380
y.create.l HWIO_QDSP_XPU_PRT4_RACR0_QDSP_ADDR A:0x37400
y.create.l HWIO_QDSP_XPU_PRT5_RACR0_QDSP_ADDR A:0x37480
y.create.l HWIO_QDSP_XPU_PRT6_RACR0_QDSP_ADDR A:0x37500
y.create.l HWIO_QDSP_XPU_PRT7_RACR0_QDSP_ADDR A:0x37580
y.create.l HWIO_QDSP_XPU_PRT8_RACR0_QDSP_ADDR A:0x37600
y.create.l HWIO_QDSP_XPU_PRT9_RACR0_QDSP_ADDR A:0x37680
y.create.l HWIO_QDSP_XPU_PRT0_START0_QDSP_ADDR A:0x37240
y.create.l HWIO_QDSP_XPU_PRT1_START0_QDSP_ADDR A:0x372c0
y.create.l HWIO_QDSP_XPU_PRT2_START0_QDSP_ADDR A:0x37340
y.create.l HWIO_QDSP_XPU_PRT3_START0_QDSP_ADDR A:0x373c0
y.create.l HWIO_QDSP_XPU_PRT4_START0_QDSP_ADDR A:0x37440
y.create.l HWIO_QDSP_XPU_PRT5_START0_QDSP_ADDR A:0x374c0
y.create.l HWIO_QDSP_XPU_PRT6_START0_QDSP_ADDR A:0x37540
y.create.l HWIO_QDSP_XPU_PRT7_START0_QDSP_ADDR A:0x375c0
y.create.l HWIO_QDSP_XPU_PRT8_START0_QDSP_ADDR A:0x37640
y.create.l HWIO_QDSP_XPU_PRT9_START0_QDSP_ADDR A:0x376c0
y.create.l HWIO_QDSP_XPU_PRT0_END0_QDSP_ADDR A:0x37248
y.create.l HWIO_QDSP_XPU_PRT1_END0_QDSP_ADDR A:0x372c8
y.create.l HWIO_QDSP_XPU_PRT2_END0_QDSP_ADDR A:0x37348
y.create.l HWIO_QDSP_XPU_PRT3_END0_QDSP_ADDR A:0x373c8
y.create.l HWIO_QDSP_XPU_PRT4_END0_QDSP_ADDR A:0x37448
y.create.l HWIO_QDSP_XPU_PRT5_END0_QDSP_ADDR A:0x374c8
y.create.l HWIO_QDSP_XPU_PRT6_END0_QDSP_ADDR A:0x37548
y.create.l HWIO_QDSP_XPU_PRT7_END0_QDSP_ADDR A:0x375c8
y.create.l HWIO_QDSP_XPU_PRT8_END0_QDSP_ADDR A:0x37648
y.create.l HWIO_QDSP_XPU_PRT9_END0_QDSP_ADDR A:0x376c8
y.create.l HWIO_QDSP_XPU_PRT0_SCR_QDSP_ADDR A:0x37250
y.create.l HWIO_QDSP_XPU_PRT1_SCR_QDSP_ADDR A:0x372d0
y.create.l HWIO_QDSP_XPU_PRT2_SCR_QDSP_ADDR A:0x37350
y.create.l HWIO_QDSP_XPU_PRT3_SCR_QDSP_ADDR A:0x373d0
y.create.l HWIO_QDSP_XPU_PRT4_SCR_QDSP_ADDR A:0x37450
y.create.l HWIO_QDSP_XPU_PRT5_SCR_QDSP_ADDR A:0x374d0
y.create.l HWIO_QDSP_XPU_PRT6_SCR_QDSP_ADDR A:0x37550
y.create.l HWIO_QDSP_XPU_PRT7_SCR_QDSP_ADDR A:0x375d0
y.create.l HWIO_QDSP_XPU_PRT8_SCR_QDSP_ADDR A:0x37650
y.create.l HWIO_QDSP_XPU_PRT9_SCR_QDSP_ADDR A:0x376d0
y.create.l HWIO_QDSP_XPU_PRT0_MCR_QDSP_ADDR A:0x37254
y.create.l HWIO_QDSP_XPU_PRT1_MCR_QDSP_ADDR A:0x372d4
y.create.l HWIO_QDSP_XPU_PRT2_MCR_QDSP_ADDR A:0x37354
y.create.l HWIO_QDSP_XPU_PRT3_MCR_QDSP_ADDR A:0x373d4
y.create.l HWIO_QDSP_XPU_PRT4_MCR_QDSP_ADDR A:0x37454
y.create.l HWIO_QDSP_XPU_PRT5_MCR_QDSP_ADDR A:0x374d4
y.create.l HWIO_QDSP_XPU_PRT6_MCR_QDSP_ADDR A:0x37554
y.create.l HWIO_QDSP_XPU_PRT7_MCR_QDSP_ADDR A:0x375d4
y.create.l HWIO_QDSP_XPU_PRT8_MCR_QDSP_ADDR A:0x37654
y.create.l HWIO_QDSP_XPU_PRT9_MCR_QDSP_ADDR A:0x376d4
y.create.l HWIO_QDSP_XPU_PRT0_CNTL0_QDSP_ADDR A:0x37258
y.create.l HWIO_QDSP_XPU_PRT1_CNTL0_QDSP_ADDR A:0x372d8
y.create.l HWIO_QDSP_XPU_PRT2_CNTL0_QDSP_ADDR A:0x37358
y.create.l HWIO_QDSP_XPU_PRT3_CNTL0_QDSP_ADDR A:0x373d8
y.create.l HWIO_QDSP_XPU_PRT4_CNTL0_QDSP_ADDR A:0x37458
y.create.l HWIO_QDSP_XPU_PRT5_CNTL0_QDSP_ADDR A:0x374d8
y.create.l HWIO_QDSP_XPU_PRT6_CNTL0_QDSP_ADDR A:0x37558
y.create.l HWIO_QDSP_XPU_PRT7_CNTL0_QDSP_ADDR A:0x375d8
y.create.l HWIO_QDSP_XPU_PRT8_CNTL0_QDSP_ADDR A:0x37658
y.create.l HWIO_QDSP_XPU_PRT9_CNTL0_QDSP_ADDR A:0x376d8
y.create.l HWIO_QDSP_XPU_PRT0_CNTL1_QDSP_ADDR A:0x3725c
y.create.l HWIO_QDSP_XPU_PRT1_CNTL1_QDSP_ADDR A:0x372dc
y.create.l HWIO_QDSP_XPU_PRT2_CNTL1_QDSP_ADDR A:0x3735c
y.create.l HWIO_QDSP_XPU_PRT3_CNTL1_QDSP_ADDR A:0x373dc
y.create.l HWIO_QDSP_XPU_PRT4_CNTL1_QDSP_ADDR A:0x3745c
y.create.l HWIO_QDSP_XPU_PRT5_CNTL1_QDSP_ADDR A:0x374dc
y.create.l HWIO_QDSP_XPU_PRT6_CNTL1_QDSP_ADDR A:0x3755c
y.create.l HWIO_QDSP_XPU_PRT7_CNTL1_QDSP_ADDR A:0x375dc
y.create.l HWIO_QDSP_XPU_PRT8_CNTL1_QDSP_ADDR A:0x3765c
y.create.l HWIO_QDSP_XPU_PRT9_CNTL1_QDSP_ADDR A:0x376dc
y.create.l HWIO_APPS_SMMU_SCR0_APPS_ADDR A:0x1e00000
y.create.l HWIO_APPS_SMMU_NSCR0_APPS_ADDR A:0x1e00400
y.create.l HWIO_APPS_SMMU_SCR1_APPS_ADDR A:0x1e00004
y.create.l HWIO_APPS_SMMU_SACR_APPS_ADDR A:0x1e00010
y.create.l HWIO_APPS_SMMU_NSACR_APPS_ADDR A:0x1e00410
y.create.l HWIO_APPS_SMMU_SIDR0_APPS_ADDR A:0x1e00020
y.create.l HWIO_APPS_SMMU_SIDR1_APPS_ADDR A:0x1e00024
y.create.l HWIO_APPS_SMMU_SIDR2_APPS_ADDR A:0x1e00028
y.create.l HWIO_APPS_SMMU_SIDR7_APPS_ADDR A:0x1e0003c
y.create.l HWIO_APPS_SMMU_SGFAR_LOW_APPS_ADDR A:0x1e00040
y.create.l HWIO_APPS_SMMU_SGFAR_HIGH_APPS_ADDR A:0x1e00044
y.create.l HWIO_APPS_SMMU_NSGFAR_LOW_APPS_ADDR A:0x1e00440
y.create.l HWIO_APPS_SMMU_NSGFAR_HIGH_APPS_ADDR A:0x1e00444
y.create.l HWIO_APPS_SMMU_SGFSR_APPS_ADDR A:0x1e00048
y.create.l HWIO_APPS_SMMU_NSGFSR_APPS_ADDR A:0x1e00448
y.create.l HWIO_APPS_SMMU_SGFSRRESTORE_APPS_ADDR A:0x1e0004c
y.create.l HWIO_APPS_SMMU_NSGFSRRESTORE_APPS_ADDR A:0x1e0044c
y.create.l HWIO_APPS_SMMU_SGFSYNR0_APPS_ADDR A:0x1e00050
y.create.l HWIO_APPS_SMMU_NSGFSYNR0_APPS_ADDR A:0x1e00450
y.create.l HWIO_APPS_SMMU_SGFSYNR1_APPS_ADDR A:0x1e00054
y.create.l HWIO_APPS_SMMU_NSGFSYNDR1_APPS_ADDR A:0x1e00454
y.create.l HWIO_APPS_SMMU_STLBIALL_APPS_ADDR A:0x1e00060
y.create.l HWIO_APPS_SMMU_TLBIVMID_APPS_ADDR A:0x1e00064
y.create.l HWIO_APPS_SMMU_TLBIALLNSNH_APPS_ADDR A:0x1e00068
y.create.l HWIO_APPS_SMMU_NSTLBGSYNC_APPS_ADDR A:0x1e00470
y.create.l HWIO_APPS_SMMU_STLBGSYNC_APPS_ADDR A:0x1e00070
y.create.l HWIO_APPS_SMMU_STLBGSTATUS_APPS_ADDR A:0x1e00074
y.create.l HWIO_APPS_SMMU_NSTLBGSTATUS_APPS_ADDR A:0x1e00474
y.create.l HWIO_APPS_SMMU_DBGRPTRTBU_APPS_ADDR A:0x1e00080
y.create.l HWIO_APPS_SMMU_DBGRDATATBU_APPS_ADDR A:0x1e00084
y.create.l HWIO_APPS_SMMU_DBGRPTRTCU_APPS_ADDR A:0x1e00088
y.create.l HWIO_APPS_SMMU_DBGRDATATCU_APPS_ADDR A:0x1e0008c
y.create.l HWIO_APPS_SMMU_STLBIVALM_LOW_APPS_ADDR A:0x1e000a0
y.create.l HWIO_APPS_SMMU_STLBIVALM_HIGH_APPS_ADDR A:0x1e000a4
y.create.l HWIO_APPS_SMMU_STLBIVAM_LOW_APPS_ADDR A:0x1e000a8
y.create.l HWIO_APPS_SMMU_STLBIVAM_HIGH_APPS_ADDR A:0x1e000ac
y.create.l HWIO_APPS_SMMU_STLBIALLM_APPS_ADDR A:0x1e000bc
y.create.l HWIO_APPS_SMMU_SMR0_APPS_ADDR A:0x1e00800
y.create.l HWIO_APPS_SMMU_SMR1_APPS_ADDR A:0x1e00804
y.create.l HWIO_APPS_SMMU_SMR2_APPS_ADDR A:0x1e00808
y.create.l HWIO_APPS_SMMU_SMR3_APPS_ADDR A:0x1e0080c
y.create.l HWIO_APPS_SMMU_SMR4_APPS_ADDR A:0x1e00810
y.create.l HWIO_APPS_SMMU_SMR5_APPS_ADDR A:0x1e00814
y.create.l HWIO_APPS_SMMU_SMR6_APPS_ADDR A:0x1e00818
y.create.l HWIO_APPS_SMMU_SMR7_APPS_ADDR A:0x1e0081c
y.create.l HWIO_APPS_SMMU_SMR8_APPS_ADDR A:0x1e00820
y.create.l HWIO_APPS_SMMU_SMR9_APPS_ADDR A:0x1e00824
y.create.l HWIO_APPS_SMMU_SMR10_APPS_ADDR A:0x1e00828
y.create.l HWIO_APPS_SMMU_SMR11_APPS_ADDR A:0x1e0082c
y.create.l HWIO_APPS_SMMU_SMR12_APPS_ADDR A:0x1e00830
y.create.l HWIO_APPS_SMMU_SMR13_APPS_ADDR A:0x1e00834
y.create.l HWIO_APPS_SMMU_SMR14_APPS_ADDR A:0x1e00838
y.create.l HWIO_APPS_SMMU_SMR15_APPS_ADDR A:0x1e0083c
y.create.l HWIO_APPS_SMMU_SMR16_APPS_ADDR A:0x1e00840
y.create.l HWIO_APPS_SMMU_SMR17_APPS_ADDR A:0x1e00844
y.create.l HWIO_APPS_SMMU_SMR18_APPS_ADDR A:0x1e00848
y.create.l HWIO_APPS_SMMU_SMR19_APPS_ADDR A:0x1e0084c
y.create.l HWIO_APPS_SMMU_SMR20_APPS_ADDR A:0x1e00850
y.create.l HWIO_APPS_SMMU_SMR21_APPS_ADDR A:0x1e00854
y.create.l HWIO_APPS_SMMU_SMR22_APPS_ADDR A:0x1e00858
y.create.l HWIO_APPS_SMMU_SMR23_APPS_ADDR A:0x1e0085c
y.create.l HWIO_APPS_SMMU_SMR24_APPS_ADDR A:0x1e00860
y.create.l HWIO_APPS_SMMU_SMR25_APPS_ADDR A:0x1e00864
y.create.l HWIO_APPS_SMMU_SMR26_APPS_ADDR A:0x1e00868
y.create.l HWIO_APPS_SMMU_SMR27_APPS_ADDR A:0x1e0086c
y.create.l HWIO_APPS_SMMU_SMR28_APPS_ADDR A:0x1e00870
y.create.l HWIO_APPS_SMMU_SMR29_APPS_ADDR A:0x1e00874
y.create.l HWIO_APPS_SMMU_SMR30_APPS_ADDR A:0x1e00878
y.create.l HWIO_APPS_SMMU_SMR31_APPS_ADDR A:0x1e0087c
y.create.l HWIO_APPS_SMMU_SMR32_APPS_ADDR A:0x1e00880
y.create.l HWIO_APPS_SMMU_SMR33_APPS_ADDR A:0x1e00884
y.create.l HWIO_APPS_SMMU_SMR34_APPS_ADDR A:0x1e00888
y.create.l HWIO_APPS_SMMU_SMR35_APPS_ADDR A:0x1e0088c
y.create.l HWIO_APPS_SMMU_SMR36_APPS_ADDR A:0x1e00890
y.create.l HWIO_APPS_SMMU_SMR37_APPS_ADDR A:0x1e00894
y.create.l HWIO_APPS_SMMU_SMR38_APPS_ADDR A:0x1e00898
y.create.l HWIO_APPS_SMMU_SMR39_APPS_ADDR A:0x1e0089c
y.create.l HWIO_APPS_SMMU_SMR40_APPS_ADDR A:0x1e008a0
y.create.l HWIO_APPS_SMMU_SMR41_APPS_ADDR A:0x1e008a4
y.create.l HWIO_APPS_SMMU_SMR42_APPS_ADDR A:0x1e008a8
y.create.l HWIO_APPS_SMMU_SMR43_APPS_ADDR A:0x1e008ac
y.create.l HWIO_APPS_SMMU_SMR44_APPS_ADDR A:0x1e008b0
y.create.l HWIO_APPS_SMMU_SMR45_APPS_ADDR A:0x1e008b4
y.create.l HWIO_APPS_SMMU_SMR46_APPS_ADDR A:0x1e008b8
y.create.l HWIO_APPS_SMMU_SMR47_APPS_ADDR A:0x1e008bc
y.create.l HWIO_APPS_SMMU_SMR48_APPS_ADDR A:0x1e008c0
y.create.l HWIO_APPS_SMMU_SMR49_APPS_ADDR A:0x1e008c4
y.create.l HWIO_APPS_SMMU_SMR50_APPS_ADDR A:0x1e008c8
y.create.l HWIO_APPS_SMMU_SMR51_APPS_ADDR A:0x1e008cc
y.create.l HWIO_APPS_SMMU_SMR52_APPS_ADDR A:0x1e008d0
y.create.l HWIO_APPS_SMMU_SMR53_APPS_ADDR A:0x1e008d4
y.create.l HWIO_APPS_SMMU_SMR54_APPS_ADDR A:0x1e008d8
y.create.l HWIO_APPS_SMMU_SMR55_APPS_ADDR A:0x1e008dc
y.create.l HWIO_APPS_SMMU_SMR56_APPS_ADDR A:0x1e008e0
y.create.l HWIO_APPS_SMMU_SMR57_APPS_ADDR A:0x1e008e4
y.create.l HWIO_APPS_SMMU_SMR58_APPS_ADDR A:0x1e008e8
y.create.l HWIO_APPS_SMMU_SMR59_APPS_ADDR A:0x1e008ec
y.create.l HWIO_APPS_SMMU_SMR60_APPS_ADDR A:0x1e008f0
y.create.l HWIO_APPS_SMMU_SMR61_APPS_ADDR A:0x1e008f4
y.create.l HWIO_APPS_SMMU_SMR62_APPS_ADDR A:0x1e008f8
y.create.l HWIO_APPS_SMMU_SMR63_APPS_ADDR A:0x1e008fc
y.create.l HWIO_APPS_SMMU_SMR64_APPS_ADDR A:0x1e00900
y.create.l HWIO_APPS_SMMU_SMR65_APPS_ADDR A:0x1e00904
y.create.l HWIO_APPS_SMMU_SMR66_APPS_ADDR A:0x1e00908
y.create.l HWIO_APPS_SMMU_SMR67_APPS_ADDR A:0x1e0090c
y.create.l HWIO_APPS_SMMU_SMR68_APPS_ADDR A:0x1e00910
y.create.l HWIO_APPS_SMMU_SMR69_APPS_ADDR A:0x1e00914
y.create.l HWIO_APPS_SMMU_SMR70_APPS_ADDR A:0x1e00918
y.create.l HWIO_APPS_SMMU_SMR71_APPS_ADDR A:0x1e0091c
y.create.l HWIO_APPS_SMMU_SMR72_APPS_ADDR A:0x1e00920
y.create.l HWIO_APPS_SMMU_SMR73_APPS_ADDR A:0x1e00924
y.create.l HWIO_APPS_SMMU_SMR74_APPS_ADDR A:0x1e00928
y.create.l HWIO_APPS_SMMU_SMR75_APPS_ADDR A:0x1e0092c
y.create.l HWIO_APPS_SMMU_SMR76_APPS_ADDR A:0x1e00930
y.create.l HWIO_APPS_SMMU_SMR77_APPS_ADDR A:0x1e00934
y.create.l HWIO_APPS_SMMU_SMR78_APPS_ADDR A:0x1e00938
y.create.l HWIO_APPS_SMMU_SMR79_APPS_ADDR A:0x1e0093c
y.create.l HWIO_APPS_SMMU_SMR80_APPS_ADDR A:0x1e00940
y.create.l HWIO_APPS_SMMU_SMR81_APPS_ADDR A:0x1e00944
y.create.l HWIO_APPS_SMMU_SMR82_APPS_ADDR A:0x1e00948
y.create.l HWIO_APPS_SMMU_SMR83_APPS_ADDR A:0x1e0094c
y.create.l HWIO_APPS_SMMU_SMR84_APPS_ADDR A:0x1e00950
y.create.l HWIO_APPS_SMMU_SMR85_APPS_ADDR A:0x1e00954
y.create.l HWIO_APPS_SMMU_SMR86_APPS_ADDR A:0x1e00958
y.create.l HWIO_APPS_SMMU_SMR87_APPS_ADDR A:0x1e0095c
y.create.l HWIO_APPS_SMMU_SMR88_APPS_ADDR A:0x1e00960
y.create.l HWIO_APPS_SMMU_SMR89_APPS_ADDR A:0x1e00964
y.create.l HWIO_APPS_SMMU_SMR90_APPS_ADDR A:0x1e00968
y.create.l HWIO_APPS_SMMU_SMR91_APPS_ADDR A:0x1e0096c
y.create.l HWIO_APPS_SMMU_SMR92_APPS_ADDR A:0x1e00970
y.create.l HWIO_APPS_SMMU_SMR93_APPS_ADDR A:0x1e00974
y.create.l HWIO_APPS_SMMU_SMR94_APPS_ADDR A:0x1e00978
y.create.l HWIO_APPS_SMMU_SMR95_APPS_ADDR A:0x1e0097c
y.create.l HWIO_APPS_SMMU_SMR96_APPS_ADDR A:0x1e00980
y.create.l HWIO_APPS_SMMU_SMR97_APPS_ADDR A:0x1e00984
y.create.l HWIO_APPS_SMMU_SMR98_APPS_ADDR A:0x1e00988
y.create.l HWIO_APPS_SMMU_SMR99_APPS_ADDR A:0x1e0098c
y.create.l HWIO_APPS_SMMU_SMR100_APPS_ADDR A:0x1e00990
y.create.l HWIO_APPS_SMMU_SMR101_APPS_ADDR A:0x1e00994
y.create.l HWIO_APPS_SMMU_SMR102_APPS_ADDR A:0x1e00998
y.create.l HWIO_APPS_SMMU_SMR103_APPS_ADDR A:0x1e0099c
y.create.l HWIO_APPS_SMMU_SMR104_APPS_ADDR A:0x1e009a0
y.create.l HWIO_APPS_SMMU_SMR105_APPS_ADDR A:0x1e009a4
y.create.l HWIO_APPS_SMMU_SMR106_APPS_ADDR A:0x1e009a8
y.create.l HWIO_APPS_SMMU_SMR107_APPS_ADDR A:0x1e009ac
y.create.l HWIO_APPS_SMMU_SMR108_APPS_ADDR A:0x1e009b0
y.create.l HWIO_APPS_SMMU_SMR109_APPS_ADDR A:0x1e009b4
y.create.l HWIO_APPS_SMMU_SMR110_APPS_ADDR A:0x1e009b8
y.create.l HWIO_APPS_SMMU_SMR111_APPS_ADDR A:0x1e009bc
y.create.l HWIO_APPS_SMMU_SMR112_APPS_ADDR A:0x1e009c0
y.create.l HWIO_APPS_SMMU_SMR113_APPS_ADDR A:0x1e009c4
y.create.l HWIO_APPS_SMMU_SMR114_APPS_ADDR A:0x1e009c8
y.create.l HWIO_APPS_SMMU_SMR115_APPS_ADDR A:0x1e009cc
y.create.l HWIO_APPS_SMMU_SMR116_APPS_ADDR A:0x1e009d0
y.create.l HWIO_APPS_SMMU_SMR117_APPS_ADDR A:0x1e009d4
y.create.l HWIO_APPS_SMMU_SMR118_APPS_ADDR A:0x1e009d8
y.create.l HWIO_APPS_SMMU_SMR119_APPS_ADDR A:0x1e009dc
y.create.l HWIO_APPS_SMMU_SMR120_APPS_ADDR A:0x1e009e0
y.create.l HWIO_APPS_SMMU_SMR121_APPS_ADDR A:0x1e009e4
y.create.l HWIO_APPS_SMMU_SMR122_APPS_ADDR A:0x1e009e8
y.create.l HWIO_APPS_SMMU_SMR123_APPS_ADDR A:0x1e009ec
y.create.l HWIO_APPS_SMMU_SMR124_APPS_ADDR A:0x1e009f0
y.create.l HWIO_APPS_SMMU_SMR125_APPS_ADDR A:0x1e009f4
y.create.l HWIO_APPS_SMMU_SMR126_APPS_ADDR A:0x1e009f8
y.create.l HWIO_APPS_SMMU_SMR127_APPS_ADDR A:0x1e009fc
y.create.l HWIO_APPS_SMMU_S2CR0_APPS_ADDR A:0x1e00c00
y.create.l HWIO_APPS_SMMU_S2CR1_APPS_ADDR A:0x1e00c04
y.create.l HWIO_APPS_SMMU_S2CR2_APPS_ADDR A:0x1e00c08
y.create.l HWIO_APPS_SMMU_S2CR3_APPS_ADDR A:0x1e00c0c
y.create.l HWIO_APPS_SMMU_S2CR4_APPS_ADDR A:0x1e00c10
y.create.l HWIO_APPS_SMMU_S2CR5_APPS_ADDR A:0x1e00c14
y.create.l HWIO_APPS_SMMU_S2CR6_APPS_ADDR A:0x1e00c18
y.create.l HWIO_APPS_SMMU_S2CR7_APPS_ADDR A:0x1e00c1c
y.create.l HWIO_APPS_SMMU_S2CR8_APPS_ADDR A:0x1e00c20
y.create.l HWIO_APPS_SMMU_S2CR9_APPS_ADDR A:0x1e00c24
y.create.l HWIO_APPS_SMMU_S2CR10_APPS_ADDR A:0x1e00c28
y.create.l HWIO_APPS_SMMU_S2CR11_APPS_ADDR A:0x1e00c2c
y.create.l HWIO_APPS_SMMU_S2CR12_APPS_ADDR A:0x1e00c30
y.create.l HWIO_APPS_SMMU_S2CR13_APPS_ADDR A:0x1e00c34
y.create.l HWIO_APPS_SMMU_S2CR14_APPS_ADDR A:0x1e00c38
y.create.l HWIO_APPS_SMMU_S2CR15_APPS_ADDR A:0x1e00c3c
y.create.l HWIO_APPS_SMMU_S2CR16_APPS_ADDR A:0x1e00c40
y.create.l HWIO_APPS_SMMU_S2CR17_APPS_ADDR A:0x1e00c44
y.create.l HWIO_APPS_SMMU_S2CR18_APPS_ADDR A:0x1e00c48
y.create.l HWIO_APPS_SMMU_S2CR19_APPS_ADDR A:0x1e00c4c
y.create.l HWIO_APPS_SMMU_S2CR20_APPS_ADDR A:0x1e00c50
y.create.l HWIO_APPS_SMMU_S2CR21_APPS_ADDR A:0x1e00c54
y.create.l HWIO_APPS_SMMU_S2CR22_APPS_ADDR A:0x1e00c58
y.create.l HWIO_APPS_SMMU_S2CR23_APPS_ADDR A:0x1e00c5c
y.create.l HWIO_APPS_SMMU_S2CR24_APPS_ADDR A:0x1e00c60
y.create.l HWIO_APPS_SMMU_S2CR25_APPS_ADDR A:0x1e00c64
y.create.l HWIO_APPS_SMMU_S2CR26_APPS_ADDR A:0x1e00c68
y.create.l HWIO_APPS_SMMU_S2CR27_APPS_ADDR A:0x1e00c6c
y.create.l HWIO_APPS_SMMU_S2CR28_APPS_ADDR A:0x1e00c70
y.create.l HWIO_APPS_SMMU_S2CR29_APPS_ADDR A:0x1e00c74
y.create.l HWIO_APPS_SMMU_S2CR30_APPS_ADDR A:0x1e00c78
y.create.l HWIO_APPS_SMMU_S2CR31_APPS_ADDR A:0x1e00c7c
y.create.l HWIO_APPS_SMMU_S2CR32_APPS_ADDR A:0x1e00c80
y.create.l HWIO_APPS_SMMU_S2CR33_APPS_ADDR A:0x1e00c84
y.create.l HWIO_APPS_SMMU_S2CR34_APPS_ADDR A:0x1e00c88
y.create.l HWIO_APPS_SMMU_S2CR35_APPS_ADDR A:0x1e00c8c
y.create.l HWIO_APPS_SMMU_S2CR36_APPS_ADDR A:0x1e00c90
y.create.l HWIO_APPS_SMMU_S2CR37_APPS_ADDR A:0x1e00c94
y.create.l HWIO_APPS_SMMU_S2CR38_APPS_ADDR A:0x1e00c98
y.create.l HWIO_APPS_SMMU_S2CR39_APPS_ADDR A:0x1e00c9c
y.create.l HWIO_APPS_SMMU_S2CR40_APPS_ADDR A:0x1e00ca0
y.create.l HWIO_APPS_SMMU_S2CR41_APPS_ADDR A:0x1e00ca4
y.create.l HWIO_APPS_SMMU_S2CR42_APPS_ADDR A:0x1e00ca8
y.create.l HWIO_APPS_SMMU_S2CR43_APPS_ADDR A:0x1e00cac
y.create.l HWIO_APPS_SMMU_S2CR44_APPS_ADDR A:0x1e00cb0
y.create.l HWIO_APPS_SMMU_S2CR45_APPS_ADDR A:0x1e00cb4
y.create.l HWIO_APPS_SMMU_S2CR46_APPS_ADDR A:0x1e00cb8
y.create.l HWIO_APPS_SMMU_S2CR47_APPS_ADDR A:0x1e00cbc
y.create.l HWIO_APPS_SMMU_S2CR48_APPS_ADDR A:0x1e00cc0
y.create.l HWIO_APPS_SMMU_S2CR49_APPS_ADDR A:0x1e00cc4
y.create.l HWIO_APPS_SMMU_S2CR50_APPS_ADDR A:0x1e00cc8
y.create.l HWIO_APPS_SMMU_S2CR51_APPS_ADDR A:0x1e00ccc
y.create.l HWIO_APPS_SMMU_S2CR52_APPS_ADDR A:0x1e00cd0
y.create.l HWIO_APPS_SMMU_S2CR53_APPS_ADDR A:0x1e00cd4
y.create.l HWIO_APPS_SMMU_S2CR54_APPS_ADDR A:0x1e00cd8
y.create.l HWIO_APPS_SMMU_S2CR55_APPS_ADDR A:0x1e00cdc
y.create.l HWIO_APPS_SMMU_S2CR56_APPS_ADDR A:0x1e00ce0
y.create.l HWIO_APPS_SMMU_S2CR57_APPS_ADDR A:0x1e00ce4
y.create.l HWIO_APPS_SMMU_S2CR58_APPS_ADDR A:0x1e00ce8
y.create.l HWIO_APPS_SMMU_S2CR59_APPS_ADDR A:0x1e00cec
y.create.l HWIO_APPS_SMMU_S2CR60_APPS_ADDR A:0x1e00cf0
y.create.l HWIO_APPS_SMMU_S2CR61_APPS_ADDR A:0x1e00cf4
y.create.l HWIO_APPS_SMMU_S2CR62_APPS_ADDR A:0x1e00cf8
y.create.l HWIO_APPS_SMMU_S2CR63_APPS_ADDR A:0x1e00cfc
y.create.l HWIO_APPS_SMMU_S2CR64_APPS_ADDR A:0x1e00d00
y.create.l HWIO_APPS_SMMU_S2CR65_APPS_ADDR A:0x1e00d04
y.create.l HWIO_APPS_SMMU_S2CR66_APPS_ADDR A:0x1e00d08
y.create.l HWIO_APPS_SMMU_S2CR67_APPS_ADDR A:0x1e00d0c
y.create.l HWIO_APPS_SMMU_S2CR68_APPS_ADDR A:0x1e00d10
y.create.l HWIO_APPS_SMMU_S2CR69_APPS_ADDR A:0x1e00d14
y.create.l HWIO_APPS_SMMU_S2CR70_APPS_ADDR A:0x1e00d18
y.create.l HWIO_APPS_SMMU_S2CR71_APPS_ADDR A:0x1e00d1c
y.create.l HWIO_APPS_SMMU_S2CR72_APPS_ADDR A:0x1e00d20
y.create.l HWIO_APPS_SMMU_S2CR73_APPS_ADDR A:0x1e00d24
y.create.l HWIO_APPS_SMMU_S2CR74_APPS_ADDR A:0x1e00d28
y.create.l HWIO_APPS_SMMU_S2CR75_APPS_ADDR A:0x1e00d2c
y.create.l HWIO_APPS_SMMU_S2CR76_APPS_ADDR A:0x1e00d30
y.create.l HWIO_APPS_SMMU_S2CR77_APPS_ADDR A:0x1e00d34
y.create.l HWIO_APPS_SMMU_S2CR78_APPS_ADDR A:0x1e00d38
y.create.l HWIO_APPS_SMMU_S2CR79_APPS_ADDR A:0x1e00d3c
y.create.l HWIO_APPS_SMMU_S2CR80_APPS_ADDR A:0x1e00d40
y.create.l HWIO_APPS_SMMU_S2CR81_APPS_ADDR A:0x1e00d44
y.create.l HWIO_APPS_SMMU_S2CR82_APPS_ADDR A:0x1e00d48
y.create.l HWIO_APPS_SMMU_S2CR83_APPS_ADDR A:0x1e00d4c
y.create.l HWIO_APPS_SMMU_S2CR84_APPS_ADDR A:0x1e00d50
y.create.l HWIO_APPS_SMMU_S2CR85_APPS_ADDR A:0x1e00d54
y.create.l HWIO_APPS_SMMU_S2CR86_APPS_ADDR A:0x1e00d58
y.create.l HWIO_APPS_SMMU_S2CR87_APPS_ADDR A:0x1e00d5c
y.create.l HWIO_APPS_SMMU_S2CR88_APPS_ADDR A:0x1e00d60
y.create.l HWIO_APPS_SMMU_S2CR89_APPS_ADDR A:0x1e00d64
y.create.l HWIO_APPS_SMMU_S2CR90_APPS_ADDR A:0x1e00d68
y.create.l HWIO_APPS_SMMU_S2CR91_APPS_ADDR A:0x1e00d6c
y.create.l HWIO_APPS_SMMU_S2CR92_APPS_ADDR A:0x1e00d70
y.create.l HWIO_APPS_SMMU_S2CR93_APPS_ADDR A:0x1e00d74
y.create.l HWIO_APPS_SMMU_S2CR94_APPS_ADDR A:0x1e00d78
y.create.l HWIO_APPS_SMMU_S2CR95_APPS_ADDR A:0x1e00d7c
y.create.l HWIO_APPS_SMMU_S2CR96_APPS_ADDR A:0x1e00d80
y.create.l HWIO_APPS_SMMU_S2CR97_APPS_ADDR A:0x1e00d84
y.create.l HWIO_APPS_SMMU_S2CR98_APPS_ADDR A:0x1e00d88
y.create.l HWIO_APPS_SMMU_S2CR99_APPS_ADDR A:0x1e00d8c
y.create.l HWIO_APPS_SMMU_S2CR100_APPS_ADDR A:0x1e00d90
y.create.l HWIO_APPS_SMMU_S2CR101_APPS_ADDR A:0x1e00d94
y.create.l HWIO_APPS_SMMU_S2CR102_APPS_ADDR A:0x1e00d98
y.create.l HWIO_APPS_SMMU_S2CR103_APPS_ADDR A:0x1e00d9c
y.create.l HWIO_APPS_SMMU_S2CR104_APPS_ADDR A:0x1e00da0
y.create.l HWIO_APPS_SMMU_S2CR105_APPS_ADDR A:0x1e00da4
y.create.l HWIO_APPS_SMMU_S2CR106_APPS_ADDR A:0x1e00da8
y.create.l HWIO_APPS_SMMU_S2CR107_APPS_ADDR A:0x1e00dac
y.create.l HWIO_APPS_SMMU_S2CR108_APPS_ADDR A:0x1e00db0
y.create.l HWIO_APPS_SMMU_S2CR109_APPS_ADDR A:0x1e00db4
y.create.l HWIO_APPS_SMMU_S2CR110_APPS_ADDR A:0x1e00db8
y.create.l HWIO_APPS_SMMU_S2CR111_APPS_ADDR A:0x1e00dbc
y.create.l HWIO_APPS_SMMU_S2CR112_APPS_ADDR A:0x1e00dc0
y.create.l HWIO_APPS_SMMU_S2CR113_APPS_ADDR A:0x1e00dc4
y.create.l HWIO_APPS_SMMU_S2CR114_APPS_ADDR A:0x1e00dc8
y.create.l HWIO_APPS_SMMU_S2CR115_APPS_ADDR A:0x1e00dcc
y.create.l HWIO_APPS_SMMU_S2CR116_APPS_ADDR A:0x1e00dd0
y.create.l HWIO_APPS_SMMU_S2CR117_APPS_ADDR A:0x1e00dd4
y.create.l HWIO_APPS_SMMU_S2CR118_APPS_ADDR A:0x1e00dd8
y.create.l HWIO_APPS_SMMU_S2CR119_APPS_ADDR A:0x1e00ddc
y.create.l HWIO_APPS_SMMU_S2CR120_APPS_ADDR A:0x1e00de0
y.create.l HWIO_APPS_SMMU_S2CR121_APPS_ADDR A:0x1e00de4
y.create.l HWIO_APPS_SMMU_S2CR122_APPS_ADDR A:0x1e00de8
y.create.l HWIO_APPS_SMMU_S2CR123_APPS_ADDR A:0x1e00dec
y.create.l HWIO_APPS_SMMU_S2CR124_APPS_ADDR A:0x1e00df0
y.create.l HWIO_APPS_SMMU_S2CR125_APPS_ADDR A:0x1e00df4
y.create.l HWIO_APPS_SMMU_S2CR126_APPS_ADDR A:0x1e00df8
y.create.l HWIO_APPS_SMMU_S2CR127_APPS_ADDR A:0x1e00dfc
y.create.l HWIO_APPS_SMMU_PIDR0_APPS_ADDR A:0x1e00fe0
y.create.l HWIO_APPS_SMMU_PIDR1_APPS_ADDR A:0x1e00fe4
y.create.l HWIO_APPS_SMMU_PIDR2_APPS_ADDR A:0x1e00fe8
y.create.l HWIO_APPS_SMMU_PIDR3_APPS_ADDR A:0x1e00fec
y.create.l HWIO_APPS_SMMU_PIDR4_APPS_ADDR A:0x1e00fd0
y.create.l HWIO_APPS_SMMU_PIDR5_APPS_ADDR A:0x1e00fd4
y.create.l HWIO_APPS_SMMU_PIDR6_APPS_ADDR A:0x1e00fd8
y.create.l HWIO_APPS_SMMU_PIDR7_APPS_ADDR A:0x1e00fdc
y.create.l HWIO_APPS_SMMU_CIDR0_APPS_ADDR A:0x1e00ff0
y.create.l HWIO_APPS_SMMU_CIDR1_APPS_ADDR A:0x1e00ff4
y.create.l HWIO_APPS_SMMU_CIDR2_APPS_ADDR A:0x1e00ff8
y.create.l HWIO_APPS_SMMU_CIDR3_APPS_ADDR A:0x1e00ffc
y.create.l HWIO_APPS_SMMU_CBAR0_APPS_ADDR A:0x1e01000
y.create.l HWIO_APPS_SMMU_CBFRSYNRA0_APPS_ADDR A:0x1e01400
y.create.l HWIO_APPS_SMMU_CBA2R0_APPS_ADDR A:0x1e01800
y.create.l HWIO_APPS_SMMU_CBAR1_APPS_ADDR A:0x1e01004
y.create.l HWIO_APPS_SMMU_CBFRSYNRA1_APPS_ADDR A:0x1e01404
y.create.l HWIO_APPS_SMMU_CBA2R1_APPS_ADDR A:0x1e01804
y.create.l HWIO_APPS_SMMU_CBAR2_APPS_ADDR A:0x1e01008
y.create.l HWIO_APPS_SMMU_CBFRSYNRA2_APPS_ADDR A:0x1e01408
y.create.l HWIO_APPS_SMMU_CBA2R2_APPS_ADDR A:0x1e01808
y.create.l HWIO_APPS_SMMU_CBAR3_APPS_ADDR A:0x1e0100c
y.create.l HWIO_APPS_SMMU_CBFRSYNRA3_APPS_ADDR A:0x1e0140c
y.create.l HWIO_APPS_SMMU_CBA2R3_APPS_ADDR A:0x1e0180c
y.create.l HWIO_APPS_SMMU_CBAR4_APPS_ADDR A:0x1e01010
y.create.l HWIO_APPS_SMMU_CBFRSYNRA4_APPS_ADDR A:0x1e01410
y.create.l HWIO_APPS_SMMU_CBA2R4_APPS_ADDR A:0x1e01810
y.create.l HWIO_APPS_SMMU_CBAR5_APPS_ADDR A:0x1e01014
y.create.l HWIO_APPS_SMMU_CBFRSYNRA5_APPS_ADDR A:0x1e01414
y.create.l HWIO_APPS_SMMU_CBA2R5_APPS_ADDR A:0x1e01814
y.create.l HWIO_APPS_SMMU_CBAR6_APPS_ADDR A:0x1e01018
y.create.l HWIO_APPS_SMMU_CBFRSYNRA6_APPS_ADDR A:0x1e01418
y.create.l HWIO_APPS_SMMU_CBA2R6_APPS_ADDR A:0x1e01818
y.create.l HWIO_APPS_SMMU_CBAR7_APPS_ADDR A:0x1e0101c
y.create.l HWIO_APPS_SMMU_CBFRSYNRA7_APPS_ADDR A:0x1e0141c
y.create.l HWIO_APPS_SMMU_CBA2R7_APPS_ADDR A:0x1e0181c
y.create.l HWIO_APPS_SMMU_CBAR8_APPS_ADDR A:0x1e01020
y.create.l HWIO_APPS_SMMU_CBFRSYNRA8_APPS_ADDR A:0x1e01420
y.create.l HWIO_APPS_SMMU_CBA2R8_APPS_ADDR A:0x1e01820
y.create.l HWIO_APPS_SMMU_CBAR9_APPS_ADDR A:0x1e01024
y.create.l HWIO_APPS_SMMU_CBFRSYNRA9_APPS_ADDR A:0x1e01424
y.create.l HWIO_APPS_SMMU_CBA2R9_APPS_ADDR A:0x1e01824
y.create.l HWIO_APPS_SMMU_CBAR10_APPS_ADDR A:0x1e01028
y.create.l HWIO_APPS_SMMU_CBFRSYNRA10_APPS_ADDR A:0x1e01428
y.create.l HWIO_APPS_SMMU_CBA2R10_APPS_ADDR A:0x1e01828
y.create.l HWIO_APPS_SMMU_CBAR11_APPS_ADDR A:0x1e0102c
y.create.l HWIO_APPS_SMMU_CBFRSYNRA11_APPS_ADDR A:0x1e0142c
y.create.l HWIO_APPS_SMMU_CBA2R11_APPS_ADDR A:0x1e0182c
y.create.l HWIO_APPS_SMMU_CBAR12_APPS_ADDR A:0x1e01030
y.create.l HWIO_APPS_SMMU_CBFRSYNRA12_APPS_ADDR A:0x1e01430
y.create.l HWIO_APPS_SMMU_CBA2R12_APPS_ADDR A:0x1e01830
y.create.l HWIO_APPS_SMMU_CBAR13_APPS_ADDR A:0x1e01034
y.create.l HWIO_APPS_SMMU_CBFRSYNRA13_APPS_ADDR A:0x1e01434
y.create.l HWIO_APPS_SMMU_CBA2R13_APPS_ADDR A:0x1e01834
y.create.l HWIO_APPS_SMMU_CBAR14_APPS_ADDR A:0x1e01038
y.create.l HWIO_APPS_SMMU_CBFRSYNRA14_APPS_ADDR A:0x1e01438
y.create.l HWIO_APPS_SMMU_CBA2R14_APPS_ADDR A:0x1e01838
y.create.l HWIO_APPS_SMMU_CBAR15_APPS_ADDR A:0x1e0103c
y.create.l HWIO_APPS_SMMU_CBFRSYNRA15_APPS_ADDR A:0x1e0143c
y.create.l HWIO_APPS_SMMU_CBA2R15_APPS_ADDR A:0x1e0183c
y.create.l HWIO_APPS_SMMU_CBAR16_APPS_ADDR A:0x1e01040
y.create.l HWIO_APPS_SMMU_CBFRSYNRA16_APPS_ADDR A:0x1e01440
y.create.l HWIO_APPS_SMMU_CBA2R16_APPS_ADDR A:0x1e01840
y.create.l HWIO_APPS_SMMU_CBAR17_APPS_ADDR A:0x1e01044
y.create.l HWIO_APPS_SMMU_CBFRSYNRA17_APPS_ADDR A:0x1e01444
y.create.l HWIO_APPS_SMMU_CBA2R17_APPS_ADDR A:0x1e01844
y.create.l HWIO_APPS_SMMU_CBAR18_APPS_ADDR A:0x1e01048
y.create.l HWIO_APPS_SMMU_CBFRSYNRA18_APPS_ADDR A:0x1e01448
y.create.l HWIO_APPS_SMMU_CBA2R18_APPS_ADDR A:0x1e01848
y.create.l HWIO_APPS_SMMU_CBAR19_APPS_ADDR A:0x1e0104c
y.create.l HWIO_APPS_SMMU_CBFRSYNRA19_APPS_ADDR A:0x1e0144c
y.create.l HWIO_APPS_SMMU_CBA2R19_APPS_ADDR A:0x1e0184c
y.create.l HWIO_APPS_SMMU_CBAR20_APPS_ADDR A:0x1e01050
y.create.l HWIO_APPS_SMMU_CBFRSYNRA20_APPS_ADDR A:0x1e01450
y.create.l HWIO_APPS_SMMU_CBA2R20_APPS_ADDR A:0x1e01850
y.create.l HWIO_APPS_SMMU_CBAR21_APPS_ADDR A:0x1e01054
y.create.l HWIO_APPS_SMMU_CBFRSYNRA21_APPS_ADDR A:0x1e01454
y.create.l HWIO_APPS_SMMU_CBA2R21_APPS_ADDR A:0x1e01854
y.create.l HWIO_APPS_SMMU_CBAR22_APPS_ADDR A:0x1e01058
y.create.l HWIO_APPS_SMMU_CBFRSYNRA22_APPS_ADDR A:0x1e01458
y.create.l HWIO_APPS_SMMU_CBA2R22_APPS_ADDR A:0x1e01858
y.create.l HWIO_APPS_SMMU_CBAR23_APPS_ADDR A:0x1e0105c
y.create.l HWIO_APPS_SMMU_CBFRSYNRA23_APPS_ADDR A:0x1e0145c
y.create.l HWIO_APPS_SMMU_CBA2R23_APPS_ADDR A:0x1e0185c
y.create.l HWIO_APPS_SMMU_CBAR24_APPS_ADDR A:0x1e01060
y.create.l HWIO_APPS_SMMU_CBFRSYNRA24_APPS_ADDR A:0x1e01460
y.create.l HWIO_APPS_SMMU_CBA2R24_APPS_ADDR A:0x1e01860
y.create.l HWIO_APPS_SMMU_CBAR25_APPS_ADDR A:0x1e01064
y.create.l HWIO_APPS_SMMU_CBFRSYNRA25_APPS_ADDR A:0x1e01464
y.create.l HWIO_APPS_SMMU_CBA2R25_APPS_ADDR A:0x1e01864
y.create.l HWIO_APPS_SMMU_CBAR26_APPS_ADDR A:0x1e01068
y.create.l HWIO_APPS_SMMU_CBFRSYNRA26_APPS_ADDR A:0x1e01468
y.create.l HWIO_APPS_SMMU_CBA2R26_APPS_ADDR A:0x1e01868
y.create.l HWIO_APPS_SMMU_CBAR27_APPS_ADDR A:0x1e0106c
y.create.l HWIO_APPS_SMMU_CBFRSYNRA27_APPS_ADDR A:0x1e0146c
y.create.l HWIO_APPS_SMMU_CBA2R27_APPS_ADDR A:0x1e0186c
y.create.l HWIO_APPS_SMMU_CBAR28_APPS_ADDR A:0x1e01070
y.create.l HWIO_APPS_SMMU_CBFRSYNRA28_APPS_ADDR A:0x1e01470
y.create.l HWIO_APPS_SMMU_CBA2R28_APPS_ADDR A:0x1e01870
y.create.l HWIO_APPS_SMMU_CBAR29_APPS_ADDR A:0x1e01074
y.create.l HWIO_APPS_SMMU_CBFRSYNRA29_APPS_ADDR A:0x1e01474
y.create.l HWIO_APPS_SMMU_CBA2R29_APPS_ADDR A:0x1e01874
y.create.l HWIO_APPS_SMMU_CBAR30_APPS_ADDR A:0x1e01078
y.create.l HWIO_APPS_SMMU_CBFRSYNRA30_APPS_ADDR A:0x1e01478
y.create.l HWIO_APPS_SMMU_CBA2R30_APPS_ADDR A:0x1e01878
y.create.l HWIO_APPS_SMMU_CBAR31_APPS_ADDR A:0x1e0107c
y.create.l HWIO_APPS_SMMU_CBFRSYNRA31_APPS_ADDR A:0x1e0147c
y.create.l HWIO_APPS_SMMU_CBA2R31_APPS_ADDR A:0x1e0187c
y.create.l HWIO_APPS_SMMU_ITCTRL_APPS_ADDR A:0x1e02000
y.create.l HWIO_APPS_SMMU_ITIP_APPS_ADDR A:0x1e02004
y.create.l HWIO_APPS_SMMU_ITOP_GLBL_APPS_ADDR A:0x1e02008
y.create.l HWIO_APPS_SMMU_ITOP_PERF_INDEX_APPS_ADDR A:0x1e0200c
y.create.l HWIO_APPS_SMMU_ITOP_CXT0TO31_RAM0_APPS_ADDR A:0x1e02010
y.create.l HWIO_APPS_SMMU_TBUQOS0_APPS_ADDR A:0x1e02100
y.create.l HWIO_APPS_SMMU_PER_APPS_ADDR A:0x1e02200
y.create.l HWIO_APPS_SMMU_TBU_PWR_STATUS_APPS_ADDR A:0x1e02204
y.create.l HWIO_APPS_PMEVCNTR0_APPS_ADDR A:0x1e03000
y.create.l HWIO_APPS_PMEVCNTR1_APPS_ADDR A:0x1e03004
y.create.l HWIO_APPS_PMEVCNTR2_APPS_ADDR A:0x1e03008
y.create.l HWIO_APPS_PMEVCNTR3_APPS_ADDR A:0x1e0300c
y.create.l HWIO_APPS_PMEVTYPER0_APPS_ADDR A:0x1e03400
y.create.l HWIO_APPS_PMEVTYPER1_APPS_ADDR A:0x1e03404
y.create.l HWIO_APPS_PMEVTYPER2_APPS_ADDR A:0x1e03408
y.create.l HWIO_APPS_PMEVTYPER3_APPS_ADDR A:0x1e0340c
y.create.l HWIO_APPS_PMCGCR_APPS_ADDR A:0x1e03800
y.create.l HWIO_APPS_PMCGSMR_APPS_ADDR A:0x1e03a00
y.create.l HWIO_APPS_PMCNTENSET_APPS_ADDR A:0x1e03c00
y.create.l HWIO_APPS_PMCNTENCLR_APPS_ADDR A:0x1e03c20
y.create.l HWIO_APPS_PMINTENSET_APPS_ADDR A:0x1e03c40
y.create.l HWIO_APPS_PMINTENCLR_APPS_ADDR A:0x1e03c60
y.create.l HWIO_APPS_PMOVSCLR_APPS_ADDR A:0x1e03c80
y.create.l HWIO_APPS_PMOVSSET_APPS_ADDR A:0x1e03cc0
y.create.l HWIO_APPS_PMCFGR_APPS_ADDR A:0x1e03e00
y.create.l HWIO_APPS_PMCR_APPS_ADDR A:0x1e03e04
y.create.l HWIO_APPS_PMCEID0_APPS_ADDR A:0x1e03e20
y.create.l HWIO_APPS_PMAUTHSTATUS_APPS_ADDR A:0x1e03fb8
y.create.l HWIO_APPS_PMDEVTYPE_APPS_ADDR A:0x1e03fcc
y.create.l HWIO_APPS_SMMU_SSD_REG_0_APPS_ADDR A:0x1e04000
y.create.l HWIO_APPS_SMMU_SSD_REG_1_APPS_ADDR A:0x1e04004
y.create.l HWIO_APPS_SMMU_SSD_REG_2_APPS_ADDR A:0x1e04008
y.create.l HWIO_APPS_SMMU_SSD_REG_3_APPS_ADDR A:0x1e0400c
y.create.l HWIO_APPS_SMMU_SSD_REG_4_APPS_ADDR A:0x1e04010
y.create.l HWIO_APPS_SMMU_SSD_REG_5_APPS_ADDR A:0x1e04014
y.create.l HWIO_APPS_SMMU_SSD_REG_6_APPS_ADDR A:0x1e04018
y.create.l HWIO_APPS_SMMU_SSD_REG_7_APPS_ADDR A:0x1e0401c
y.create.l HWIO_APPS_SMMU_SSD_REG_8_APPS_ADDR A:0x1e04020
y.create.l HWIO_APPS_SMMU_SSD_REG_9_APPS_ADDR A:0x1e04024
y.create.l HWIO_APPS_SMMU_SSD_REG_10_APPS_ADDR A:0x1e04028
y.create.l HWIO_APPS_SMMU_SSD_REG_11_APPS_ADDR A:0x1e0402c
y.create.l HWIO_APPS_SMMU_SSD_REG_12_APPS_ADDR A:0x1e04030
y.create.l HWIO_APPS_SMMU_SSD_REG_13_APPS_ADDR A:0x1e04034
y.create.l HWIO_APPS_SMMU_SSD_REG_14_APPS_ADDR A:0x1e04038
y.create.l HWIO_APPS_SMMU_SSD_REG_15_APPS_ADDR A:0x1e0403c
y.create.l HWIO_APPS_SMMU_SSD_REG_16_APPS_ADDR A:0x1e04040
y.create.l HWIO_APPS_SMMU_SSD_REG_17_APPS_ADDR A:0x1e04044
y.create.l HWIO_APPS_SMMU_SSD_REG_18_APPS_ADDR A:0x1e04048
y.create.l HWIO_APPS_SMMU_SSD_REG_19_APPS_ADDR A:0x1e0404c
y.create.l HWIO_APPS_SMMU_SSD_REG_20_APPS_ADDR A:0x1e04050
y.create.l HWIO_APPS_SMMU_SSD_REG_21_APPS_ADDR A:0x1e04054
y.create.l HWIO_APPS_SMMU_SSD_REG_22_APPS_ADDR A:0x1e04058
y.create.l HWIO_APPS_SMMU_SSD_REG_23_APPS_ADDR A:0x1e0405c
y.create.l HWIO_APPS_SMMU_SSD_REG_24_APPS_ADDR A:0x1e04060
y.create.l HWIO_APPS_SMMU_SSD_REG_25_APPS_ADDR A:0x1e04064
y.create.l HWIO_APPS_SMMU_SSD_REG_26_APPS_ADDR A:0x1e04068
y.create.l HWIO_APPS_SMMU_SSD_REG_27_APPS_ADDR A:0x1e0406c
y.create.l HWIO_APPS_SMMU_SSD_REG_28_APPS_ADDR A:0x1e04070
y.create.l HWIO_APPS_SMMU_SSD_REG_29_APPS_ADDR A:0x1e04074
y.create.l HWIO_APPS_SMMU_SSD_REG_30_APPS_ADDR A:0x1e04078
y.create.l HWIO_APPS_SMMU_SSD_REG_31_APPS_ADDR A:0x1e0407c
y.create.l HWIO_APPS_SMMU_SSD_REG_32_APPS_ADDR A:0x1e04080
y.create.l HWIO_APPS_SMMU_SSD_REG_33_APPS_ADDR A:0x1e04084
y.create.l HWIO_APPS_SMMU_SSD_REG_34_APPS_ADDR A:0x1e04088
y.create.l HWIO_APPS_SMMU_SSD_REG_35_APPS_ADDR A:0x1e0408c
y.create.l HWIO_APPS_SMMU_SSD_REG_36_APPS_ADDR A:0x1e04090
y.create.l HWIO_APPS_SMMU_SSD_REG_37_APPS_ADDR A:0x1e04094
y.create.l HWIO_APPS_SMMU_SSD_REG_38_APPS_ADDR A:0x1e04098
y.create.l HWIO_APPS_SMMU_SSD_REG_39_APPS_ADDR A:0x1e0409c
y.create.l HWIO_APPS_SMMU_SSD_REG_40_APPS_ADDR A:0x1e040a0
y.create.l HWIO_APPS_SMMU_SSD_REG_41_APPS_ADDR A:0x1e040a4
y.create.l HWIO_APPS_SMMU_SSD_REG_42_APPS_ADDR A:0x1e040a8
y.create.l HWIO_APPS_SMMU_SSD_REG_43_APPS_ADDR A:0x1e040ac
y.create.l HWIO_APPS_SMMU_SSD_REG_44_APPS_ADDR A:0x1e040b0
y.create.l HWIO_APPS_SMMU_SSD_REG_45_APPS_ADDR A:0x1e040b4
y.create.l HWIO_APPS_SMMU_SSD_REG_46_APPS_ADDR A:0x1e040b8
y.create.l HWIO_APPS_SMMU_SSD_REG_47_APPS_ADDR A:0x1e040bc
y.create.l HWIO_APPS_SMMU_SSD_REG_48_APPS_ADDR A:0x1e040c0
y.create.l HWIO_APPS_SMMU_SSD_REG_49_APPS_ADDR A:0x1e040c4
y.create.l HWIO_APPS_SMMU_SSD_REG_50_APPS_ADDR A:0x1e040c8
y.create.l HWIO_APPS_SMMU_SSD_REG_51_APPS_ADDR A:0x1e040cc
y.create.l HWIO_APPS_SMMU_SSD_REG_52_APPS_ADDR A:0x1e040d0
y.create.l HWIO_APPS_SMMU_SSD_REG_53_APPS_ADDR A:0x1e040d4
y.create.l HWIO_APPS_SMMU_SSD_REG_54_APPS_ADDR A:0x1e040d8
y.create.l HWIO_APPS_SMMU_SSD_REG_55_APPS_ADDR A:0x1e040dc
y.create.l HWIO_APPS_SMMU_SSD_REG_56_APPS_ADDR A:0x1e040e0
y.create.l HWIO_APPS_SMMU_SSD_REG_57_APPS_ADDR A:0x1e040e4
y.create.l HWIO_APPS_SMMU_SSD_REG_58_APPS_ADDR A:0x1e040e8
y.create.l HWIO_APPS_SMMU_SSD_REG_59_APPS_ADDR A:0x1e040ec
y.create.l HWIO_APPS_SMMU_SSD_REG_60_APPS_ADDR A:0x1e040f0
y.create.l HWIO_APPS_SMMU_SSD_REG_61_APPS_ADDR A:0x1e040f4
y.create.l HWIO_APPS_SMMU_SSD_REG_62_APPS_ADDR A:0x1e040f8
y.create.l HWIO_APPS_SMMU_SSD_REG_63_APPS_ADDR A:0x1e040fc
y.create.l HWIO_APPS_SMMU_SSD_REG_64_APPS_ADDR A:0x1e04100
y.create.l HWIO_APPS_SMMU_SSD_REG_65_APPS_ADDR A:0x1e04104
y.create.l HWIO_APPS_SMMU_SSD_REG_66_APPS_ADDR A:0x1e04108
y.create.l HWIO_APPS_SMMU_SSD_REG_67_APPS_ADDR A:0x1e0410c
y.create.l HWIO_APPS_SMMU_SSD_REG_68_APPS_ADDR A:0x1e04110
y.create.l HWIO_APPS_SMMU_SSD_REG_69_APPS_ADDR A:0x1e04114
y.create.l HWIO_APPS_SMMU_SSD_REG_70_APPS_ADDR A:0x1e04118
y.create.l HWIO_APPS_SMMU_SSD_REG_71_APPS_ADDR A:0x1e0411c
y.create.l HWIO_APPS_SMMU_SSD_REG_72_APPS_ADDR A:0x1e04120
y.create.l HWIO_APPS_SMMU_SSD_REG_73_APPS_ADDR A:0x1e04124
y.create.l HWIO_APPS_SMMU_SSD_REG_74_APPS_ADDR A:0x1e04128
y.create.l HWIO_APPS_SMMU_SSD_REG_75_APPS_ADDR A:0x1e0412c
y.create.l HWIO_APPS_SMMU_SSD_REG_76_APPS_ADDR A:0x1e04130
y.create.l HWIO_APPS_SMMU_SSD_REG_77_APPS_ADDR A:0x1e04134
y.create.l HWIO_APPS_SMMU_SSD_REG_78_APPS_ADDR A:0x1e04138
y.create.l HWIO_APPS_SMMU_SSD_REG_79_APPS_ADDR A:0x1e0413c
y.create.l HWIO_APPS_SMMU_SSD_REG_80_APPS_ADDR A:0x1e04140
y.create.l HWIO_APPS_SMMU_SSD_REG_81_APPS_ADDR A:0x1e04144
y.create.l HWIO_APPS_SMMU_SSD_REG_82_APPS_ADDR A:0x1e04148
y.create.l HWIO_APPS_SMMU_SSD_REG_83_APPS_ADDR A:0x1e0414c
y.create.l HWIO_APPS_SMMU_SSD_REG_84_APPS_ADDR A:0x1e04150
y.create.l HWIO_APPS_SMMU_SSD_REG_85_APPS_ADDR A:0x1e04154
y.create.l HWIO_APPS_SMMU_SSD_REG_86_APPS_ADDR A:0x1e04158
y.create.l HWIO_APPS_SMMU_SSD_REG_87_APPS_ADDR A:0x1e0415c
y.create.l HWIO_APPS_SMMU_SSD_REG_88_APPS_ADDR A:0x1e04160
y.create.l HWIO_APPS_SMMU_SSD_REG_89_APPS_ADDR A:0x1e04164
y.create.l HWIO_APPS_SMMU_SSD_REG_90_APPS_ADDR A:0x1e04168
y.create.l HWIO_APPS_SMMU_SSD_REG_91_APPS_ADDR A:0x1e0416c
y.create.l HWIO_APPS_SMMU_SSD_REG_92_APPS_ADDR A:0x1e04170
y.create.l HWIO_APPS_SMMU_SSD_REG_93_APPS_ADDR A:0x1e04174
y.create.l HWIO_APPS_SMMU_SSD_REG_94_APPS_ADDR A:0x1e04178
y.create.l HWIO_APPS_SMMU_SSD_REG_95_APPS_ADDR A:0x1e0417c
y.create.l HWIO_APPS_SMMU_SSD_REG_96_APPS_ADDR A:0x1e04180
y.create.l HWIO_APPS_SMMU_SSD_REG_97_APPS_ADDR A:0x1e04184
y.create.l HWIO_APPS_SMMU_SSD_REG_98_APPS_ADDR A:0x1e04188
y.create.l HWIO_APPS_SMMU_SSD_REG_99_APPS_ADDR A:0x1e0418c
y.create.l HWIO_APPS_SMMU_SSD_REG_100_APPS_ADDR A:0x1e04190
y.create.l HWIO_APPS_SMMU_SSD_REG_101_APPS_ADDR A:0x1e04194
y.create.l HWIO_APPS_SMMU_SSD_REG_102_APPS_ADDR A:0x1e04198
y.create.l HWIO_APPS_SMMU_SSD_REG_103_APPS_ADDR A:0x1e0419c
y.create.l HWIO_APPS_SMMU_SSD_REG_104_APPS_ADDR A:0x1e041a0
y.create.l HWIO_APPS_SMMU_SSD_REG_105_APPS_ADDR A:0x1e041a4
y.create.l HWIO_APPS_SMMU_SSD_REG_106_APPS_ADDR A:0x1e041a8
y.create.l HWIO_APPS_SMMU_SSD_REG_107_APPS_ADDR A:0x1e041ac
y.create.l HWIO_APPS_SMMU_SSD_REG_108_APPS_ADDR A:0x1e041b0
y.create.l HWIO_APPS_SMMU_SSD_REG_109_APPS_ADDR A:0x1e041b4
y.create.l HWIO_APPS_SMMU_SSD_REG_110_APPS_ADDR A:0x1e041b8
y.create.l HWIO_APPS_SMMU_SSD_REG_111_APPS_ADDR A:0x1e041bc
y.create.l HWIO_APPS_SMMU_SSD_REG_112_APPS_ADDR A:0x1e041c0
y.create.l HWIO_APPS_SMMU_SSD_REG_113_APPS_ADDR A:0x1e041c4
y.create.l HWIO_APPS_SMMU_SSD_REG_114_APPS_ADDR A:0x1e041c8
y.create.l HWIO_APPS_SMMU_SSD_REG_115_APPS_ADDR A:0x1e041cc
y.create.l HWIO_APPS_SMMU_SSD_REG_116_APPS_ADDR A:0x1e041d0
y.create.l HWIO_APPS_SMMU_SSD_REG_117_APPS_ADDR A:0x1e041d4
y.create.l HWIO_APPS_SMMU_SSD_REG_118_APPS_ADDR A:0x1e041d8
y.create.l HWIO_APPS_SMMU_SSD_REG_119_APPS_ADDR A:0x1e041dc
y.create.l HWIO_APPS_SMMU_SSD_REG_120_APPS_ADDR A:0x1e041e0
y.create.l HWIO_APPS_SMMU_SSD_REG_121_APPS_ADDR A:0x1e041e4
y.create.l HWIO_APPS_SMMU_SSD_REG_122_APPS_ADDR A:0x1e041e8
y.create.l HWIO_APPS_SMMU_SSD_REG_123_APPS_ADDR A:0x1e041ec
y.create.l HWIO_APPS_SMMU_SSD_REG_124_APPS_ADDR A:0x1e041f0
y.create.l HWIO_APPS_SMMU_SSD_REG_125_APPS_ADDR A:0x1e041f4
y.create.l HWIO_APPS_SMMU_SSD_REG_126_APPS_ADDR A:0x1e041f8
y.create.l HWIO_APPS_SMMU_SSD_REG_127_APPS_ADDR A:0x1e041fc
y.create.l HWIO_APPS_SMMU_SSD_REG_128_APPS_ADDR A:0x1e04200
y.create.l HWIO_APPS_SMMU_SSD_REG_129_APPS_ADDR A:0x1e04204
y.create.l HWIO_APPS_SMMU_SSD_REG_130_APPS_ADDR A:0x1e04208
y.create.l HWIO_APPS_SMMU_SSD_REG_131_APPS_ADDR A:0x1e0420c
y.create.l HWIO_APPS_SMMU_SSD_REG_132_APPS_ADDR A:0x1e04210
y.create.l HWIO_APPS_SMMU_SSD_REG_133_APPS_ADDR A:0x1e04214
y.create.l HWIO_APPS_SMMU_SSD_REG_134_APPS_ADDR A:0x1e04218
y.create.l HWIO_APPS_SMMU_SSD_REG_135_APPS_ADDR A:0x1e0421c
y.create.l HWIO_APPS_SMMU_SSD_REG_136_APPS_ADDR A:0x1e04220
y.create.l HWIO_APPS_SMMU_SSD_REG_137_APPS_ADDR A:0x1e04224
y.create.l HWIO_APPS_SMMU_SSD_REG_138_APPS_ADDR A:0x1e04228
y.create.l HWIO_APPS_SMMU_SSD_REG_139_APPS_ADDR A:0x1e0422c
y.create.l HWIO_APPS_SMMU_SSD_REG_140_APPS_ADDR A:0x1e04230
y.create.l HWIO_APPS_SMMU_SSD_REG_141_APPS_ADDR A:0x1e04234
y.create.l HWIO_APPS_SMMU_SSD_REG_142_APPS_ADDR A:0x1e04238
y.create.l HWIO_APPS_SMMU_SSD_REG_143_APPS_ADDR A:0x1e0423c
y.create.l HWIO_APPS_SMMU_SSD_REG_144_APPS_ADDR A:0x1e04240
y.create.l HWIO_APPS_SMMU_SSD_REG_145_APPS_ADDR A:0x1e04244
y.create.l HWIO_APPS_SMMU_SSD_REG_146_APPS_ADDR A:0x1e04248
y.create.l HWIO_APPS_SMMU_SSD_REG_147_APPS_ADDR A:0x1e0424c
y.create.l HWIO_APPS_SMMU_SSD_REG_148_APPS_ADDR A:0x1e04250
y.create.l HWIO_APPS_SMMU_SSD_REG_149_APPS_ADDR A:0x1e04254
y.create.l HWIO_APPS_SMMU_SSD_REG_150_APPS_ADDR A:0x1e04258
y.create.l HWIO_APPS_SMMU_SSD_REG_151_APPS_ADDR A:0x1e0425c
y.create.l HWIO_APPS_SMMU_SSD_REG_152_APPS_ADDR A:0x1e04260
y.create.l HWIO_APPS_SMMU_SSD_REG_153_APPS_ADDR A:0x1e04264
y.create.l HWIO_APPS_SMMU_SSD_REG_154_APPS_ADDR A:0x1e04268
y.create.l HWIO_APPS_SMMU_SSD_REG_155_APPS_ADDR A:0x1e0426c
y.create.l HWIO_APPS_SMMU_SSD_REG_156_APPS_ADDR A:0x1e04270
y.create.l HWIO_APPS_SMMU_SSD_REG_157_APPS_ADDR A:0x1e04274
y.create.l HWIO_APPS_SMMU_SSD_REG_158_APPS_ADDR A:0x1e04278
y.create.l HWIO_APPS_SMMU_SSD_REG_159_APPS_ADDR A:0x1e0427c
y.create.l HWIO_APPS_SMMU_SSD_REG_160_APPS_ADDR A:0x1e04280
y.create.l HWIO_APPS_SMMU_SSD_REG_161_APPS_ADDR A:0x1e04284
y.create.l HWIO_APPS_SMMU_SSD_REG_162_APPS_ADDR A:0x1e04288
y.create.l HWIO_APPS_SMMU_SSD_REG_163_APPS_ADDR A:0x1e0428c
y.create.l HWIO_APPS_SMMU_SSD_REG_164_APPS_ADDR A:0x1e04290
y.create.l HWIO_APPS_SMMU_SSD_REG_165_APPS_ADDR A:0x1e04294
y.create.l HWIO_APPS_SMMU_SSD_REG_166_APPS_ADDR A:0x1e04298
y.create.l HWIO_APPS_SMMU_SSD_REG_167_APPS_ADDR A:0x1e0429c
y.create.l HWIO_APPS_SMMU_SSD_REG_168_APPS_ADDR A:0x1e042a0
y.create.l HWIO_APPS_SMMU_SSD_REG_169_APPS_ADDR A:0x1e042a4
y.create.l HWIO_APPS_SMMU_SSD_REG_170_APPS_ADDR A:0x1e042a8
y.create.l HWIO_APPS_SMMU_SSD_REG_171_APPS_ADDR A:0x1e042ac
y.create.l HWIO_APPS_SMMU_SSD_REG_172_APPS_ADDR A:0x1e042b0
y.create.l HWIO_APPS_SMMU_SSD_REG_173_APPS_ADDR A:0x1e042b4
y.create.l HWIO_APPS_SMMU_SSD_REG_174_APPS_ADDR A:0x1e042b8
y.create.l HWIO_APPS_SMMU_SSD_REG_175_APPS_ADDR A:0x1e042bc
y.create.l HWIO_APPS_SMMU_SSD_REG_176_APPS_ADDR A:0x1e042c0
y.create.l HWIO_APPS_SMMU_SSD_REG_177_APPS_ADDR A:0x1e042c4
y.create.l HWIO_APPS_SMMU_SSD_REG_178_APPS_ADDR A:0x1e042c8
y.create.l HWIO_APPS_SMMU_SSD_REG_179_APPS_ADDR A:0x1e042cc
y.create.l HWIO_APPS_SMMU_SSD_REG_180_APPS_ADDR A:0x1e042d0
y.create.l HWIO_APPS_SMMU_SSD_REG_181_APPS_ADDR A:0x1e042d4
y.create.l HWIO_APPS_SMMU_SSD_REG_182_APPS_ADDR A:0x1e042d8
y.create.l HWIO_APPS_SMMU_SSD_REG_183_APPS_ADDR A:0x1e042dc
y.create.l HWIO_APPS_SMMU_SSD_REG_184_APPS_ADDR A:0x1e042e0
y.create.l HWIO_APPS_SMMU_SSD_REG_185_APPS_ADDR A:0x1e042e4
y.create.l HWIO_APPS_SMMU_SSD_REG_186_APPS_ADDR A:0x1e042e8
y.create.l HWIO_APPS_SMMU_SSD_REG_187_APPS_ADDR A:0x1e042ec
y.create.l HWIO_APPS_SMMU_SSD_REG_188_APPS_ADDR A:0x1e042f0
y.create.l HWIO_APPS_SMMU_SSD_REG_189_APPS_ADDR A:0x1e042f4
y.create.l HWIO_APPS_SMMU_SSD_REG_190_APPS_ADDR A:0x1e042f8
y.create.l HWIO_APPS_SMMU_SSD_REG_191_APPS_ADDR A:0x1e042fc
y.create.l HWIO_APPS_SMMU_SSD_REG_192_APPS_ADDR A:0x1e04300
y.create.l HWIO_APPS_SMMU_SSD_REG_193_APPS_ADDR A:0x1e04304
y.create.l HWIO_APPS_SMMU_SSD_REG_194_APPS_ADDR A:0x1e04308
y.create.l HWIO_APPS_SMMU_SSD_REG_195_APPS_ADDR A:0x1e0430c
y.create.l HWIO_APPS_SMMU_SSD_REG_196_APPS_ADDR A:0x1e04310
y.create.l HWIO_APPS_SMMU_SSD_REG_197_APPS_ADDR A:0x1e04314
y.create.l HWIO_APPS_SMMU_SSD_REG_198_APPS_ADDR A:0x1e04318
y.create.l HWIO_APPS_SMMU_SSD_REG_199_APPS_ADDR A:0x1e0431c
y.create.l HWIO_APPS_SMMU_SSD_REG_200_APPS_ADDR A:0x1e04320
y.create.l HWIO_APPS_SMMU_SSD_REG_201_APPS_ADDR A:0x1e04324
y.create.l HWIO_APPS_SMMU_SSD_REG_202_APPS_ADDR A:0x1e04328
y.create.l HWIO_APPS_SMMU_SSD_REG_203_APPS_ADDR A:0x1e0432c
y.create.l HWIO_APPS_SMMU_SSD_REG_204_APPS_ADDR A:0x1e04330
y.create.l HWIO_APPS_SMMU_SSD_REG_205_APPS_ADDR A:0x1e04334
y.create.l HWIO_APPS_SMMU_SSD_REG_206_APPS_ADDR A:0x1e04338
y.create.l HWIO_APPS_SMMU_SSD_REG_207_APPS_ADDR A:0x1e0433c
y.create.l HWIO_APPS_SMMU_SSD_REG_208_APPS_ADDR A:0x1e04340
y.create.l HWIO_APPS_SMMU_SSD_REG_209_APPS_ADDR A:0x1e04344
y.create.l HWIO_APPS_SMMU_SSD_REG_210_APPS_ADDR A:0x1e04348
y.create.l HWIO_APPS_SMMU_SSD_REG_211_APPS_ADDR A:0x1e0434c
y.create.l HWIO_APPS_SMMU_SSD_REG_212_APPS_ADDR A:0x1e04350
y.create.l HWIO_APPS_SMMU_SSD_REG_213_APPS_ADDR A:0x1e04354
y.create.l HWIO_APPS_SMMU_SSD_REG_214_APPS_ADDR A:0x1e04358
y.create.l HWIO_APPS_SMMU_SSD_REG_215_APPS_ADDR A:0x1e0435c
y.create.l HWIO_APPS_SMMU_SSD_REG_216_APPS_ADDR A:0x1e04360
y.create.l HWIO_APPS_SMMU_SSD_REG_217_APPS_ADDR A:0x1e04364
y.create.l HWIO_APPS_SMMU_SSD_REG_218_APPS_ADDR A:0x1e04368
y.create.l HWIO_APPS_SMMU_SSD_REG_219_APPS_ADDR A:0x1e0436c
y.create.l HWIO_APPS_SMMU_SSD_REG_220_APPS_ADDR A:0x1e04370
y.create.l HWIO_APPS_SMMU_SSD_REG_221_APPS_ADDR A:0x1e04374
y.create.l HWIO_APPS_SMMU_SSD_REG_222_APPS_ADDR A:0x1e04378
y.create.l HWIO_APPS_SMMU_SSD_REG_223_APPS_ADDR A:0x1e0437c
y.create.l HWIO_APPS_SMMU_SSD_REG_224_APPS_ADDR A:0x1e04380
y.create.l HWIO_APPS_SMMU_SSD_REG_225_APPS_ADDR A:0x1e04384
y.create.l HWIO_APPS_SMMU_SSD_REG_226_APPS_ADDR A:0x1e04388
y.create.l HWIO_APPS_SMMU_SSD_REG_227_APPS_ADDR A:0x1e0438c
y.create.l HWIO_APPS_SMMU_SSD_REG_228_APPS_ADDR A:0x1e04390
y.create.l HWIO_APPS_SMMU_SSD_REG_229_APPS_ADDR A:0x1e04394
y.create.l HWIO_APPS_SMMU_SSD_REG_230_APPS_ADDR A:0x1e04398
y.create.l HWIO_APPS_SMMU_SSD_REG_231_APPS_ADDR A:0x1e0439c
y.create.l HWIO_APPS_SMMU_SSD_REG_232_APPS_ADDR A:0x1e043a0
y.create.l HWIO_APPS_SMMU_SSD_REG_233_APPS_ADDR A:0x1e043a4
y.create.l HWIO_APPS_SMMU_SSD_REG_234_APPS_ADDR A:0x1e043a8
y.create.l HWIO_APPS_SMMU_SSD_REG_235_APPS_ADDR A:0x1e043ac
y.create.l HWIO_APPS_SMMU_SSD_REG_236_APPS_ADDR A:0x1e043b0
y.create.l HWIO_APPS_SMMU_SSD_REG_237_APPS_ADDR A:0x1e043b4
y.create.l HWIO_APPS_SMMU_SSD_REG_238_APPS_ADDR A:0x1e043b8
y.create.l HWIO_APPS_SMMU_SSD_REG_239_APPS_ADDR A:0x1e043bc
y.create.l HWIO_APPS_SMMU_SSD_REG_240_APPS_ADDR A:0x1e043c0
y.create.l HWIO_APPS_SMMU_SSD_REG_241_APPS_ADDR A:0x1e043c4
y.create.l HWIO_APPS_SMMU_SSD_REG_242_APPS_ADDR A:0x1e043c8
y.create.l HWIO_APPS_SMMU_SSD_REG_243_APPS_ADDR A:0x1e043cc
y.create.l HWIO_APPS_SMMU_SSD_REG_244_APPS_ADDR A:0x1e043d0
y.create.l HWIO_APPS_SMMU_SSD_REG_245_APPS_ADDR A:0x1e043d4
y.create.l HWIO_APPS_SMMU_SSD_REG_246_APPS_ADDR A:0x1e043d8
y.create.l HWIO_APPS_SMMU_SSD_REG_247_APPS_ADDR A:0x1e043dc
y.create.l HWIO_APPS_SMMU_SSD_REG_248_APPS_ADDR A:0x1e043e0
y.create.l HWIO_APPS_SMMU_SSD_REG_249_APPS_ADDR A:0x1e043e4
y.create.l HWIO_APPS_SMMU_SSD_REG_250_APPS_ADDR A:0x1e043e8
y.create.l HWIO_APPS_SMMU_SSD_REG_251_APPS_ADDR A:0x1e043ec
y.create.l HWIO_APPS_SMMU_SSD_REG_252_APPS_ADDR A:0x1e043f0
y.create.l HWIO_APPS_SMMU_SSD_REG_253_APPS_ADDR A:0x1e043f4
y.create.l HWIO_APPS_SMMU_SSD_REG_254_APPS_ADDR A:0x1e043f8
y.create.l HWIO_APPS_SMMU_SSD_REG_255_APPS_ADDR A:0x1e043fc
y.create.l HWIO_APPS_SMMU_SSD_REG_256_APPS_ADDR A:0x1e04400
y.create.l HWIO_APPS_SMMU_SSD_REG_257_APPS_ADDR A:0x1e04404
y.create.l HWIO_APPS_SMMU_SSD_REG_258_APPS_ADDR A:0x1e04408
y.create.l HWIO_APPS_SMMU_SSD_REG_259_APPS_ADDR A:0x1e0440c
y.create.l HWIO_APPS_SMMU_SSD_REG_260_APPS_ADDR A:0x1e04410
y.create.l HWIO_APPS_SMMU_SSD_REG_261_APPS_ADDR A:0x1e04414
y.create.l HWIO_APPS_SMMU_SSD_REG_262_APPS_ADDR A:0x1e04418
y.create.l HWIO_APPS_SMMU_SSD_REG_263_APPS_ADDR A:0x1e0441c
y.create.l HWIO_APPS_SMMU_SSD_REG_264_APPS_ADDR A:0x1e04420
y.create.l HWIO_APPS_SMMU_SSD_REG_265_APPS_ADDR A:0x1e04424
y.create.l HWIO_APPS_SMMU_SSD_REG_266_APPS_ADDR A:0x1e04428
y.create.l HWIO_APPS_SMMU_SSD_REG_267_APPS_ADDR A:0x1e0442c
y.create.l HWIO_APPS_SMMU_SSD_REG_268_APPS_ADDR A:0x1e04430
y.create.l HWIO_APPS_SMMU_SSD_REG_269_APPS_ADDR A:0x1e04434
y.create.l HWIO_APPS_SMMU_SSD_REG_270_APPS_ADDR A:0x1e04438
y.create.l HWIO_APPS_SMMU_SSD_REG_271_APPS_ADDR A:0x1e0443c
y.create.l HWIO_APPS_SMMU_SSD_REG_272_APPS_ADDR A:0x1e04440
y.create.l HWIO_APPS_SMMU_SSD_REG_273_APPS_ADDR A:0x1e04444
y.create.l HWIO_APPS_SMMU_SSD_REG_274_APPS_ADDR A:0x1e04448
y.create.l HWIO_APPS_SMMU_SSD_REG_275_APPS_ADDR A:0x1e0444c
y.create.l HWIO_APPS_SMMU_SSD_REG_276_APPS_ADDR A:0x1e04450
y.create.l HWIO_APPS_SMMU_SSD_REG_277_APPS_ADDR A:0x1e04454
y.create.l HWIO_APPS_SMMU_SSD_REG_278_APPS_ADDR A:0x1e04458
y.create.l HWIO_APPS_SMMU_SSD_REG_279_APPS_ADDR A:0x1e0445c
y.create.l HWIO_APPS_SMMU_SSD_REG_280_APPS_ADDR A:0x1e04460
y.create.l HWIO_APPS_SMMU_SSD_REG_281_APPS_ADDR A:0x1e04464
y.create.l HWIO_APPS_SMMU_SSD_REG_282_APPS_ADDR A:0x1e04468
y.create.l HWIO_APPS_SMMU_SSD_REG_283_APPS_ADDR A:0x1e0446c
y.create.l HWIO_APPS_SMMU_SSD_REG_284_APPS_ADDR A:0x1e04470
y.create.l HWIO_APPS_SMMU_SSD_REG_285_APPS_ADDR A:0x1e04474
y.create.l HWIO_APPS_SMMU_SSD_REG_286_APPS_ADDR A:0x1e04478
y.create.l HWIO_APPS_SMMU_SSD_REG_287_APPS_ADDR A:0x1e0447c
y.create.l HWIO_APPS_SMMU_SSD_REG_288_APPS_ADDR A:0x1e04480
y.create.l HWIO_APPS_SMMU_SSD_REG_289_APPS_ADDR A:0x1e04484
y.create.l HWIO_APPS_SMMU_SSD_REG_290_APPS_ADDR A:0x1e04488
y.create.l HWIO_APPS_SMMU_SSD_REG_291_APPS_ADDR A:0x1e0448c
y.create.l HWIO_APPS_SMMU_SSD_REG_292_APPS_ADDR A:0x1e04490
y.create.l HWIO_APPS_SMMU_SSD_REG_293_APPS_ADDR A:0x1e04494
y.create.l HWIO_APPS_SMMU_SSD_REG_294_APPS_ADDR A:0x1e04498
y.create.l HWIO_APPS_SMMU_SSD_REG_295_APPS_ADDR A:0x1e0449c
y.create.l HWIO_APPS_SMMU_SSD_REG_296_APPS_ADDR A:0x1e044a0
y.create.l HWIO_APPS_SMMU_SSD_REG_297_APPS_ADDR A:0x1e044a4
y.create.l HWIO_APPS_SMMU_SSD_REG_298_APPS_ADDR A:0x1e044a8
y.create.l HWIO_APPS_SMMU_SSD_REG_299_APPS_ADDR A:0x1e044ac
y.create.l HWIO_APPS_SMMU_SSD_REG_300_APPS_ADDR A:0x1e044b0
y.create.l HWIO_APPS_SMMU_SSD_REG_301_APPS_ADDR A:0x1e044b4
y.create.l HWIO_APPS_SMMU_SSD_REG_302_APPS_ADDR A:0x1e044b8
y.create.l HWIO_APPS_SMMU_SSD_REG_303_APPS_ADDR A:0x1e044bc
y.create.l HWIO_APPS_SMMU_SSD_REG_304_APPS_ADDR A:0x1e044c0
y.create.l HWIO_APPS_SMMU_SSD_REG_305_APPS_ADDR A:0x1e044c4
y.create.l HWIO_APPS_SMMU_SSD_REG_306_APPS_ADDR A:0x1e044c8
y.create.l HWIO_APPS_SMMU_SSD_REG_307_APPS_ADDR A:0x1e044cc
y.create.l HWIO_APPS_SMMU_SSD_REG_308_APPS_ADDR A:0x1e044d0
y.create.l HWIO_APPS_SMMU_SSD_REG_309_APPS_ADDR A:0x1e044d4
y.create.l HWIO_APPS_SMMU_SSD_REG_310_APPS_ADDR A:0x1e044d8
y.create.l HWIO_APPS_SMMU_SSD_REG_311_APPS_ADDR A:0x1e044dc
y.create.l HWIO_APPS_SMMU_SSD_REG_312_APPS_ADDR A:0x1e044e0
y.create.l HWIO_APPS_SMMU_SSD_REG_313_APPS_ADDR A:0x1e044e4
y.create.l HWIO_APPS_SMMU_SSD_REG_314_APPS_ADDR A:0x1e044e8
y.create.l HWIO_APPS_SMMU_SSD_REG_315_APPS_ADDR A:0x1e044ec
y.create.l HWIO_APPS_SMMU_SSD_REG_316_APPS_ADDR A:0x1e044f0
y.create.l HWIO_APPS_SMMU_SSD_REG_317_APPS_ADDR A:0x1e044f4
y.create.l HWIO_APPS_SMMU_SSD_REG_318_APPS_ADDR A:0x1e044f8
y.create.l HWIO_APPS_SMMU_SSD_REG_319_APPS_ADDR A:0x1e044fc
y.create.l HWIO_APPS_SMMU_SSD_REG_320_APPS_ADDR A:0x1e04500
y.create.l HWIO_APPS_SMMU_SSD_REG_321_APPS_ADDR A:0x1e04504
y.create.l HWIO_APPS_SMMU_SSD_REG_322_APPS_ADDR A:0x1e04508
y.create.l HWIO_APPS_SMMU_SSD_REG_323_APPS_ADDR A:0x1e0450c
y.create.l HWIO_APPS_SMMU_SSD_REG_324_APPS_ADDR A:0x1e04510
y.create.l HWIO_APPS_SMMU_SSD_REG_325_APPS_ADDR A:0x1e04514
y.create.l HWIO_APPS_SMMU_SSD_REG_326_APPS_ADDR A:0x1e04518
y.create.l HWIO_APPS_SMMU_SSD_REG_327_APPS_ADDR A:0x1e0451c
y.create.l HWIO_APPS_SMMU_SSD_REG_328_APPS_ADDR A:0x1e04520
y.create.l HWIO_APPS_SMMU_SSD_REG_329_APPS_ADDR A:0x1e04524
y.create.l HWIO_APPS_SMMU_SSD_REG_330_APPS_ADDR A:0x1e04528
y.create.l HWIO_APPS_SMMU_SSD_REG_331_APPS_ADDR A:0x1e0452c
y.create.l HWIO_APPS_SMMU_SSD_REG_332_APPS_ADDR A:0x1e04530
y.create.l HWIO_APPS_SMMU_SSD_REG_333_APPS_ADDR A:0x1e04534
y.create.l HWIO_APPS_SMMU_SSD_REG_334_APPS_ADDR A:0x1e04538
y.create.l HWIO_APPS_SMMU_SSD_REG_335_APPS_ADDR A:0x1e0453c
y.create.l HWIO_APPS_SMMU_SSD_REG_336_APPS_ADDR A:0x1e04540
y.create.l HWIO_APPS_SMMU_SSD_REG_337_APPS_ADDR A:0x1e04544
y.create.l HWIO_APPS_SMMU_SSD_REG_338_APPS_ADDR A:0x1e04548
y.create.l HWIO_APPS_SMMU_SSD_REG_339_APPS_ADDR A:0x1e0454c
y.create.l HWIO_APPS_SMMU_SSD_REG_340_APPS_ADDR A:0x1e04550
y.create.l HWIO_APPS_SMMU_SSD_REG_341_APPS_ADDR A:0x1e04554
y.create.l HWIO_APPS_SMMU_SSD_REG_342_APPS_ADDR A:0x1e04558
y.create.l HWIO_APPS_SMMU_SSD_REG_343_APPS_ADDR A:0x1e0455c
y.create.l HWIO_APPS_SMMU_SSD_REG_344_APPS_ADDR A:0x1e04560
y.create.l HWIO_APPS_SMMU_SSD_REG_345_APPS_ADDR A:0x1e04564
y.create.l HWIO_APPS_SMMU_SSD_REG_346_APPS_ADDR A:0x1e04568
y.create.l HWIO_APPS_SMMU_SSD_REG_347_APPS_ADDR A:0x1e0456c
y.create.l HWIO_APPS_SMMU_SSD_REG_348_APPS_ADDR A:0x1e04570
y.create.l HWIO_APPS_SMMU_SSD_REG_349_APPS_ADDR A:0x1e04574
y.create.l HWIO_APPS_SMMU_SSD_REG_350_APPS_ADDR A:0x1e04578
y.create.l HWIO_APPS_SMMU_SSD_REG_351_APPS_ADDR A:0x1e0457c
y.create.l HWIO_APPS_SMMU_SSD_REG_352_APPS_ADDR A:0x1e04580
y.create.l HWIO_APPS_SMMU_SSD_REG_353_APPS_ADDR A:0x1e04584
y.create.l HWIO_APPS_SMMU_SSD_REG_354_APPS_ADDR A:0x1e04588
y.create.l HWIO_APPS_SMMU_SSD_REG_355_APPS_ADDR A:0x1e0458c
y.create.l HWIO_APPS_SMMU_SSD_REG_356_APPS_ADDR A:0x1e04590
y.create.l HWIO_APPS_SMMU_SSD_REG_357_APPS_ADDR A:0x1e04594
y.create.l HWIO_APPS_SMMU_SSD_REG_358_APPS_ADDR A:0x1e04598
y.create.l HWIO_APPS_SMMU_SSD_REG_359_APPS_ADDR A:0x1e0459c
y.create.l HWIO_APPS_SMMU_SSD_REG_360_APPS_ADDR A:0x1e045a0
y.create.l HWIO_APPS_SMMU_SSD_REG_361_APPS_ADDR A:0x1e045a4
y.create.l HWIO_APPS_SMMU_SSD_REG_362_APPS_ADDR A:0x1e045a8
y.create.l HWIO_APPS_SMMU_SSD_REG_363_APPS_ADDR A:0x1e045ac
y.create.l HWIO_APPS_SMMU_SSD_REG_364_APPS_ADDR A:0x1e045b0
y.create.l HWIO_APPS_SMMU_SSD_REG_365_APPS_ADDR A:0x1e045b4
y.create.l HWIO_APPS_SMMU_SSD_REG_366_APPS_ADDR A:0x1e045b8
y.create.l HWIO_APPS_SMMU_SSD_REG_367_APPS_ADDR A:0x1e045bc
y.create.l HWIO_APPS_SMMU_SSD_REG_368_APPS_ADDR A:0x1e045c0
y.create.l HWIO_APPS_SMMU_SSD_REG_369_APPS_ADDR A:0x1e045c4
y.create.l HWIO_APPS_SMMU_SSD_REG_370_APPS_ADDR A:0x1e045c8
y.create.l HWIO_APPS_SMMU_SSD_REG_371_APPS_ADDR A:0x1e045cc
y.create.l HWIO_APPS_SMMU_SSD_REG_372_APPS_ADDR A:0x1e045d0
y.create.l HWIO_APPS_SMMU_SSD_REG_373_APPS_ADDR A:0x1e045d4
y.create.l HWIO_APPS_SMMU_SSD_REG_374_APPS_ADDR A:0x1e045d8
y.create.l HWIO_APPS_SMMU_SSD_REG_375_APPS_ADDR A:0x1e045dc
y.create.l HWIO_APPS_SMMU_SSD_REG_376_APPS_ADDR A:0x1e045e0
y.create.l HWIO_APPS_SMMU_SSD_REG_377_APPS_ADDR A:0x1e045e4
y.create.l HWIO_APPS_SMMU_SSD_REG_378_APPS_ADDR A:0x1e045e8
y.create.l HWIO_APPS_SMMU_SSD_REG_379_APPS_ADDR A:0x1e045ec
y.create.l HWIO_APPS_SMMU_SSD_REG_380_APPS_ADDR A:0x1e045f0
y.create.l HWIO_APPS_SMMU_SSD_REG_381_APPS_ADDR A:0x1e045f4
y.create.l HWIO_APPS_SMMU_SSD_REG_382_APPS_ADDR A:0x1e045f8
y.create.l HWIO_APPS_SMMU_SSD_REG_383_APPS_ADDR A:0x1e045fc
y.create.l HWIO_APPS_SMMU_SSD_REG_384_APPS_ADDR A:0x1e04600
y.create.l HWIO_APPS_SMMU_SSD_REG_385_APPS_ADDR A:0x1e04604
y.create.l HWIO_APPS_SMMU_SSD_REG_386_APPS_ADDR A:0x1e04608
y.create.l HWIO_APPS_SMMU_SSD_REG_387_APPS_ADDR A:0x1e0460c
y.create.l HWIO_APPS_SMMU_SSD_REG_388_APPS_ADDR A:0x1e04610
y.create.l HWIO_APPS_SMMU_SSD_REG_389_APPS_ADDR A:0x1e04614
y.create.l HWIO_APPS_SMMU_SSD_REG_390_APPS_ADDR A:0x1e04618
y.create.l HWIO_APPS_SMMU_SSD_REG_391_APPS_ADDR A:0x1e0461c
y.create.l HWIO_APPS_SMMU_SSD_REG_392_APPS_ADDR A:0x1e04620
y.create.l HWIO_APPS_SMMU_SSD_REG_393_APPS_ADDR A:0x1e04624
y.create.l HWIO_APPS_SMMU_SSD_REG_394_APPS_ADDR A:0x1e04628
y.create.l HWIO_APPS_SMMU_SSD_REG_395_APPS_ADDR A:0x1e0462c
y.create.l HWIO_APPS_SMMU_SSD_REG_396_APPS_ADDR A:0x1e04630
y.create.l HWIO_APPS_SMMU_SSD_REG_397_APPS_ADDR A:0x1e04634
y.create.l HWIO_APPS_SMMU_SSD_REG_398_APPS_ADDR A:0x1e04638
y.create.l HWIO_APPS_SMMU_SSD_REG_399_APPS_ADDR A:0x1e0463c
y.create.l HWIO_APPS_SMMU_SSD_REG_400_APPS_ADDR A:0x1e04640
y.create.l HWIO_APPS_SMMU_SSD_REG_401_APPS_ADDR A:0x1e04644
y.create.l HWIO_APPS_SMMU_SSD_REG_402_APPS_ADDR A:0x1e04648
y.create.l HWIO_APPS_SMMU_SSD_REG_403_APPS_ADDR A:0x1e0464c
y.create.l HWIO_APPS_SMMU_SSD_REG_404_APPS_ADDR A:0x1e04650
y.create.l HWIO_APPS_SMMU_SSD_REG_405_APPS_ADDR A:0x1e04654
y.create.l HWIO_APPS_SMMU_SSD_REG_406_APPS_ADDR A:0x1e04658
y.create.l HWIO_APPS_SMMU_SSD_REG_407_APPS_ADDR A:0x1e0465c
y.create.l HWIO_APPS_SMMU_SSD_REG_408_APPS_ADDR A:0x1e04660
y.create.l HWIO_APPS_SMMU_SSD_REG_409_APPS_ADDR A:0x1e04664
y.create.l HWIO_APPS_SMMU_SSD_REG_410_APPS_ADDR A:0x1e04668
y.create.l HWIO_APPS_SMMU_SSD_REG_411_APPS_ADDR A:0x1e0466c
y.create.l HWIO_APPS_SMMU_SSD_REG_412_APPS_ADDR A:0x1e04670
y.create.l HWIO_APPS_SMMU_SSD_REG_413_APPS_ADDR A:0x1e04674
y.create.l HWIO_APPS_SMMU_SSD_REG_414_APPS_ADDR A:0x1e04678
y.create.l HWIO_APPS_SMMU_SSD_REG_415_APPS_ADDR A:0x1e0467c
y.create.l HWIO_APPS_SMMU_SSD_REG_416_APPS_ADDR A:0x1e04680
y.create.l HWIO_APPS_SMMU_SSD_REG_417_APPS_ADDR A:0x1e04684
y.create.l HWIO_APPS_SMMU_SSD_REG_418_APPS_ADDR A:0x1e04688
y.create.l HWIO_APPS_SMMU_SSD_REG_419_APPS_ADDR A:0x1e0468c
y.create.l HWIO_APPS_SMMU_SSD_REG_420_APPS_ADDR A:0x1e04690
y.create.l HWIO_APPS_SMMU_SSD_REG_421_APPS_ADDR A:0x1e04694
y.create.l HWIO_APPS_SMMU_SSD_REG_422_APPS_ADDR A:0x1e04698
y.create.l HWIO_APPS_SMMU_SSD_REG_423_APPS_ADDR A:0x1e0469c
y.create.l HWIO_APPS_SMMU_SSD_REG_424_APPS_ADDR A:0x1e046a0
y.create.l HWIO_APPS_SMMU_SSD_REG_425_APPS_ADDR A:0x1e046a4
y.create.l HWIO_APPS_SMMU_SSD_REG_426_APPS_ADDR A:0x1e046a8
y.create.l HWIO_APPS_SMMU_SSD_REG_427_APPS_ADDR A:0x1e046ac
y.create.l HWIO_APPS_SMMU_SSD_REG_428_APPS_ADDR A:0x1e046b0
y.create.l HWIO_APPS_SMMU_SSD_REG_429_APPS_ADDR A:0x1e046b4
y.create.l HWIO_APPS_SMMU_SSD_REG_430_APPS_ADDR A:0x1e046b8
y.create.l HWIO_APPS_SMMU_SSD_REG_431_APPS_ADDR A:0x1e046bc
y.create.l HWIO_APPS_SMMU_SSD_REG_432_APPS_ADDR A:0x1e046c0
y.create.l HWIO_APPS_SMMU_SSD_REG_433_APPS_ADDR A:0x1e046c4
y.create.l HWIO_APPS_SMMU_SSD_REG_434_APPS_ADDR A:0x1e046c8
y.create.l HWIO_APPS_SMMU_SSD_REG_435_APPS_ADDR A:0x1e046cc
y.create.l HWIO_APPS_SMMU_SSD_REG_436_APPS_ADDR A:0x1e046d0
y.create.l HWIO_APPS_SMMU_SSD_REG_437_APPS_ADDR A:0x1e046d4
y.create.l HWIO_APPS_SMMU_SSD_REG_438_APPS_ADDR A:0x1e046d8
y.create.l HWIO_APPS_SMMU_SSD_REG_439_APPS_ADDR A:0x1e046dc
y.create.l HWIO_APPS_SMMU_SSD_REG_440_APPS_ADDR A:0x1e046e0
y.create.l HWIO_APPS_SMMU_SSD_REG_441_APPS_ADDR A:0x1e046e4
y.create.l HWIO_APPS_SMMU_SSD_REG_442_APPS_ADDR A:0x1e046e8
y.create.l HWIO_APPS_SMMU_SSD_REG_443_APPS_ADDR A:0x1e046ec
y.create.l HWIO_APPS_SMMU_SSD_REG_444_APPS_ADDR A:0x1e046f0
y.create.l HWIO_APPS_SMMU_SSD_REG_445_APPS_ADDR A:0x1e046f4
y.create.l HWIO_APPS_SMMU_SSD_REG_446_APPS_ADDR A:0x1e046f8
y.create.l HWIO_APPS_SMMU_SSD_REG_447_APPS_ADDR A:0x1e046fc
y.create.l HWIO_APPS_SMMU_SSD_REG_448_APPS_ADDR A:0x1e04700
y.create.l HWIO_APPS_SMMU_SSD_REG_449_APPS_ADDR A:0x1e04704
y.create.l HWIO_APPS_SMMU_SSD_REG_450_APPS_ADDR A:0x1e04708
y.create.l HWIO_APPS_SMMU_SSD_REG_451_APPS_ADDR A:0x1e0470c
y.create.l HWIO_APPS_SMMU_SSD_REG_452_APPS_ADDR A:0x1e04710
y.create.l HWIO_APPS_SMMU_SSD_REG_453_APPS_ADDR A:0x1e04714
y.create.l HWIO_APPS_SMMU_SSD_REG_454_APPS_ADDR A:0x1e04718
y.create.l HWIO_APPS_SMMU_SSD_REG_455_APPS_ADDR A:0x1e0471c
y.create.l HWIO_APPS_SMMU_SSD_REG_456_APPS_ADDR A:0x1e04720
y.create.l HWIO_APPS_SMMU_SSD_REG_457_APPS_ADDR A:0x1e04724
y.create.l HWIO_APPS_SMMU_SSD_REG_458_APPS_ADDR A:0x1e04728
y.create.l HWIO_APPS_SMMU_SSD_REG_459_APPS_ADDR A:0x1e0472c
y.create.l HWIO_APPS_SMMU_SSD_REG_460_APPS_ADDR A:0x1e04730
y.create.l HWIO_APPS_SMMU_SSD_REG_461_APPS_ADDR A:0x1e04734
y.create.l HWIO_APPS_SMMU_SSD_REG_462_APPS_ADDR A:0x1e04738
y.create.l HWIO_APPS_SMMU_SSD_REG_463_APPS_ADDR A:0x1e0473c
y.create.l HWIO_APPS_SMMU_SSD_REG_464_APPS_ADDR A:0x1e04740
y.create.l HWIO_APPS_SMMU_SSD_REG_465_APPS_ADDR A:0x1e04744
y.create.l HWIO_APPS_SMMU_SSD_REG_466_APPS_ADDR A:0x1e04748
y.create.l HWIO_APPS_SMMU_SSD_REG_467_APPS_ADDR A:0x1e0474c
y.create.l HWIO_APPS_SMMU_SSD_REG_468_APPS_ADDR A:0x1e04750
y.create.l HWIO_APPS_SMMU_SSD_REG_469_APPS_ADDR A:0x1e04754
y.create.l HWIO_APPS_SMMU_SSD_REG_470_APPS_ADDR A:0x1e04758
y.create.l HWIO_APPS_SMMU_SSD_REG_471_APPS_ADDR A:0x1e0475c
y.create.l HWIO_APPS_SMMU_SSD_REG_472_APPS_ADDR A:0x1e04760
y.create.l HWIO_APPS_SMMU_SSD_REG_473_APPS_ADDR A:0x1e04764
y.create.l HWIO_APPS_SMMU_SSD_REG_474_APPS_ADDR A:0x1e04768
y.create.l HWIO_APPS_SMMU_SSD_REG_475_APPS_ADDR A:0x1e0476c
y.create.l HWIO_APPS_SMMU_SSD_REG_476_APPS_ADDR A:0x1e04770
y.create.l HWIO_APPS_SMMU_SSD_REG_477_APPS_ADDR A:0x1e04774
y.create.l HWIO_APPS_SMMU_SSD_REG_478_APPS_ADDR A:0x1e04778
y.create.l HWIO_APPS_SMMU_SSD_REG_479_APPS_ADDR A:0x1e0477c
y.create.l HWIO_APPS_SMMU_SSD_REG_480_APPS_ADDR A:0x1e04780
y.create.l HWIO_APPS_SMMU_SSD_REG_481_APPS_ADDR A:0x1e04784
y.create.l HWIO_APPS_SMMU_SSD_REG_482_APPS_ADDR A:0x1e04788
y.create.l HWIO_APPS_SMMU_SSD_REG_483_APPS_ADDR A:0x1e0478c
y.create.l HWIO_APPS_SMMU_SSD_REG_484_APPS_ADDR A:0x1e04790
y.create.l HWIO_APPS_SMMU_SSD_REG_485_APPS_ADDR A:0x1e04794
y.create.l HWIO_APPS_SMMU_SSD_REG_486_APPS_ADDR A:0x1e04798
y.create.l HWIO_APPS_SMMU_SSD_REG_487_APPS_ADDR A:0x1e0479c
y.create.l HWIO_APPS_SMMU_SSD_REG_488_APPS_ADDR A:0x1e047a0
y.create.l HWIO_APPS_SMMU_SSD_REG_489_APPS_ADDR A:0x1e047a4
y.create.l HWIO_APPS_SMMU_SSD_REG_490_APPS_ADDR A:0x1e047a8
y.create.l HWIO_APPS_SMMU_SSD_REG_491_APPS_ADDR A:0x1e047ac
y.create.l HWIO_APPS_SMMU_SSD_REG_492_APPS_ADDR A:0x1e047b0
y.create.l HWIO_APPS_SMMU_SSD_REG_493_APPS_ADDR A:0x1e047b4
y.create.l HWIO_APPS_SMMU_SSD_REG_494_APPS_ADDR A:0x1e047b8
y.create.l HWIO_APPS_SMMU_SSD_REG_495_APPS_ADDR A:0x1e047bc
y.create.l HWIO_APPS_SMMU_SSD_REG_496_APPS_ADDR A:0x1e047c0
y.create.l HWIO_APPS_SMMU_SSD_REG_497_APPS_ADDR A:0x1e047c4
y.create.l HWIO_APPS_SMMU_SSD_REG_498_APPS_ADDR A:0x1e047c8
y.create.l HWIO_APPS_SMMU_SSD_REG_499_APPS_ADDR A:0x1e047cc
y.create.l HWIO_APPS_SMMU_SSD_REG_500_APPS_ADDR A:0x1e047d0
y.create.l HWIO_APPS_SMMU_SSD_REG_501_APPS_ADDR A:0x1e047d4
y.create.l HWIO_APPS_SMMU_SSD_REG_502_APPS_ADDR A:0x1e047d8
y.create.l HWIO_APPS_SMMU_SSD_REG_503_APPS_ADDR A:0x1e047dc
y.create.l HWIO_APPS_SMMU_SSD_REG_504_APPS_ADDR A:0x1e047e0
y.create.l HWIO_APPS_SMMU_SSD_REG_505_APPS_ADDR A:0x1e047e4
y.create.l HWIO_APPS_SMMU_SSD_REG_506_APPS_ADDR A:0x1e047e8
y.create.l HWIO_APPS_SMMU_SSD_REG_507_APPS_ADDR A:0x1e047ec
y.create.l HWIO_APPS_SMMU_SSD_REG_508_APPS_ADDR A:0x1e047f0
y.create.l HWIO_APPS_SMMU_SSD_REG_509_APPS_ADDR A:0x1e047f4
y.create.l HWIO_APPS_SMMU_SSD_REG_510_APPS_ADDR A:0x1e047f8
y.create.l HWIO_APPS_SMMU_SSD_REG_511_APPS_ADDR A:0x1e047fc
y.create.l HWIO_APPS_SMMU_SSD_REG_512_APPS_ADDR A:0x1e04800
y.create.l HWIO_APPS_SMMU_SSD_REG_513_APPS_ADDR A:0x1e04804
y.create.l HWIO_APPS_SMMU_SSD_REG_514_APPS_ADDR A:0x1e04808
y.create.l HWIO_APPS_SMMU_SSD_REG_515_APPS_ADDR A:0x1e0480c
y.create.l HWIO_APPS_SMMU_SSD_REG_516_APPS_ADDR A:0x1e04810
y.create.l HWIO_APPS_SMMU_SSD_REG_517_APPS_ADDR A:0x1e04814
y.create.l HWIO_APPS_SMMU_SSD_REG_518_APPS_ADDR A:0x1e04818
y.create.l HWIO_APPS_SMMU_SSD_REG_519_APPS_ADDR A:0x1e0481c
y.create.l HWIO_APPS_SMMU_SSD_REG_520_APPS_ADDR A:0x1e04820
y.create.l HWIO_APPS_SMMU_SSD_REG_521_APPS_ADDR A:0x1e04824
y.create.l HWIO_APPS_SMMU_SSD_REG_522_APPS_ADDR A:0x1e04828
y.create.l HWIO_APPS_SMMU_SSD_REG_523_APPS_ADDR A:0x1e0482c
y.create.l HWIO_APPS_SMMU_SSD_REG_524_APPS_ADDR A:0x1e04830
y.create.l HWIO_APPS_SMMU_SSD_REG_525_APPS_ADDR A:0x1e04834
y.create.l HWIO_APPS_SMMU_SSD_REG_526_APPS_ADDR A:0x1e04838
y.create.l HWIO_APPS_SMMU_SSD_REG_527_APPS_ADDR A:0x1e0483c
y.create.l HWIO_APPS_SMMU_SSD_REG_528_APPS_ADDR A:0x1e04840
y.create.l HWIO_APPS_SMMU_SSD_REG_529_APPS_ADDR A:0x1e04844
y.create.l HWIO_APPS_SMMU_SSD_REG_530_APPS_ADDR A:0x1e04848
y.create.l HWIO_APPS_SMMU_SSD_REG_531_APPS_ADDR A:0x1e0484c
y.create.l HWIO_APPS_SMMU_SSD_REG_532_APPS_ADDR A:0x1e04850
y.create.l HWIO_APPS_SMMU_SSD_REG_533_APPS_ADDR A:0x1e04854
y.create.l HWIO_APPS_SMMU_SSD_REG_534_APPS_ADDR A:0x1e04858
y.create.l HWIO_APPS_SMMU_SSD_REG_535_APPS_ADDR A:0x1e0485c
y.create.l HWIO_APPS_SMMU_SSD_REG_536_APPS_ADDR A:0x1e04860
y.create.l HWIO_APPS_SMMU_SSD_REG_537_APPS_ADDR A:0x1e04864
y.create.l HWIO_APPS_SMMU_SSD_REG_538_APPS_ADDR A:0x1e04868
y.create.l HWIO_APPS_SMMU_SSD_REG_539_APPS_ADDR A:0x1e0486c
y.create.l HWIO_APPS_SMMU_SSD_REG_540_APPS_ADDR A:0x1e04870
y.create.l HWIO_APPS_SMMU_SSD_REG_541_APPS_ADDR A:0x1e04874
y.create.l HWIO_APPS_SMMU_SSD_REG_542_APPS_ADDR A:0x1e04878
y.create.l HWIO_APPS_SMMU_SSD_REG_543_APPS_ADDR A:0x1e0487c
y.create.l HWIO_APPS_SMMU_SSD_REG_544_APPS_ADDR A:0x1e04880
y.create.l HWIO_APPS_SMMU_SSD_REG_545_APPS_ADDR A:0x1e04884
y.create.l HWIO_APPS_SMMU_SSD_REG_546_APPS_ADDR A:0x1e04888
y.create.l HWIO_APPS_SMMU_SSD_REG_547_APPS_ADDR A:0x1e0488c
y.create.l HWIO_APPS_SMMU_SSD_REG_548_APPS_ADDR A:0x1e04890
y.create.l HWIO_APPS_SMMU_SSD_REG_549_APPS_ADDR A:0x1e04894
y.create.l HWIO_APPS_SMMU_SSD_REG_550_APPS_ADDR A:0x1e04898
y.create.l HWIO_APPS_SMMU_SSD_REG_551_APPS_ADDR A:0x1e0489c
y.create.l HWIO_APPS_SMMU_SSD_REG_552_APPS_ADDR A:0x1e048a0
y.create.l HWIO_APPS_SMMU_SSD_REG_553_APPS_ADDR A:0x1e048a4
y.create.l HWIO_APPS_SMMU_SSD_REG_554_APPS_ADDR A:0x1e048a8
y.create.l HWIO_APPS_SMMU_SSD_REG_555_APPS_ADDR A:0x1e048ac
y.create.l HWIO_APPS_SMMU_SSD_REG_556_APPS_ADDR A:0x1e048b0
y.create.l HWIO_APPS_SMMU_SSD_REG_557_APPS_ADDR A:0x1e048b4
y.create.l HWIO_APPS_SMMU_SSD_REG_558_APPS_ADDR A:0x1e048b8
y.create.l HWIO_APPS_SMMU_SSD_REG_559_APPS_ADDR A:0x1e048bc
y.create.l HWIO_APPS_SMMU_SSD_REG_560_APPS_ADDR A:0x1e048c0
y.create.l HWIO_APPS_SMMU_SSD_REG_561_APPS_ADDR A:0x1e048c4
y.create.l HWIO_APPS_SMMU_SSD_REG_562_APPS_ADDR A:0x1e048c8
y.create.l HWIO_APPS_SMMU_SSD_REG_563_APPS_ADDR A:0x1e048cc
y.create.l HWIO_APPS_SMMU_SSD_REG_564_APPS_ADDR A:0x1e048d0
y.create.l HWIO_APPS_SMMU_SSD_REG_565_APPS_ADDR A:0x1e048d4
y.create.l HWIO_APPS_SMMU_SSD_REG_566_APPS_ADDR A:0x1e048d8
y.create.l HWIO_APPS_SMMU_SSD_REG_567_APPS_ADDR A:0x1e048dc
y.create.l HWIO_APPS_SMMU_SSD_REG_568_APPS_ADDR A:0x1e048e0
y.create.l HWIO_APPS_SMMU_SSD_REG_569_APPS_ADDR A:0x1e048e4
y.create.l HWIO_APPS_SMMU_SSD_REG_570_APPS_ADDR A:0x1e048e8
y.create.l HWIO_APPS_SMMU_SSD_REG_571_APPS_ADDR A:0x1e048ec
y.create.l HWIO_APPS_SMMU_SSD_REG_572_APPS_ADDR A:0x1e048f0
y.create.l HWIO_APPS_SMMU_SSD_REG_573_APPS_ADDR A:0x1e048f4
y.create.l HWIO_APPS_SMMU_SSD_REG_574_APPS_ADDR A:0x1e048f8
y.create.l HWIO_APPS_SMMU_SSD_REG_575_APPS_ADDR A:0x1e048fc
y.create.l HWIO_APPS_SMMU_SSD_REG_576_APPS_ADDR A:0x1e04900
y.create.l HWIO_APPS_SMMU_SSD_REG_577_APPS_ADDR A:0x1e04904
y.create.l HWIO_APPS_SMMU_SSD_REG_578_APPS_ADDR A:0x1e04908
y.create.l HWIO_APPS_SMMU_SSD_REG_579_APPS_ADDR A:0x1e0490c
y.create.l HWIO_APPS_SMMU_SSD_REG_580_APPS_ADDR A:0x1e04910
y.create.l HWIO_APPS_SMMU_SSD_REG_581_APPS_ADDR A:0x1e04914
y.create.l HWIO_APPS_SMMU_SSD_REG_582_APPS_ADDR A:0x1e04918
y.create.l HWIO_APPS_SMMU_SSD_REG_583_APPS_ADDR A:0x1e0491c
y.create.l HWIO_APPS_SMMU_SSD_REG_584_APPS_ADDR A:0x1e04920
y.create.l HWIO_APPS_SMMU_SSD_REG_585_APPS_ADDR A:0x1e04924
y.create.l HWIO_APPS_SMMU_SSD_REG_586_APPS_ADDR A:0x1e04928
y.create.l HWIO_APPS_SMMU_SSD_REG_587_APPS_ADDR A:0x1e0492c
y.create.l HWIO_APPS_SMMU_SSD_REG_588_APPS_ADDR A:0x1e04930
y.create.l HWIO_APPS_SMMU_SSD_REG_589_APPS_ADDR A:0x1e04934
y.create.l HWIO_APPS_SMMU_SSD_REG_590_APPS_ADDR A:0x1e04938
y.create.l HWIO_APPS_SMMU_SSD_REG_591_APPS_ADDR A:0x1e0493c
y.create.l HWIO_APPS_SMMU_SSD_REG_592_APPS_ADDR A:0x1e04940
y.create.l HWIO_APPS_SMMU_SSD_REG_593_APPS_ADDR A:0x1e04944
y.create.l HWIO_APPS_SMMU_SSD_REG_594_APPS_ADDR A:0x1e04948
y.create.l HWIO_APPS_SMMU_SSD_REG_595_APPS_ADDR A:0x1e0494c
y.create.l HWIO_APPS_SMMU_SSD_REG_596_APPS_ADDR A:0x1e04950
y.create.l HWIO_APPS_SMMU_SSD_REG_597_APPS_ADDR A:0x1e04954
y.create.l HWIO_APPS_SMMU_SSD_REG_598_APPS_ADDR A:0x1e04958
y.create.l HWIO_APPS_SMMU_SSD_REG_599_APPS_ADDR A:0x1e0495c
y.create.l HWIO_APPS_SMMU_SSD_REG_600_APPS_ADDR A:0x1e04960
y.create.l HWIO_APPS_SMMU_SSD_REG_601_APPS_ADDR A:0x1e04964
y.create.l HWIO_APPS_SMMU_SSD_REG_602_APPS_ADDR A:0x1e04968
y.create.l HWIO_APPS_SMMU_SSD_REG_603_APPS_ADDR A:0x1e0496c
y.create.l HWIO_APPS_SMMU_SSD_REG_604_APPS_ADDR A:0x1e04970
y.create.l HWIO_APPS_SMMU_SSD_REG_605_APPS_ADDR A:0x1e04974
y.create.l HWIO_APPS_SMMU_SSD_REG_606_APPS_ADDR A:0x1e04978
y.create.l HWIO_APPS_SMMU_SSD_REG_607_APPS_ADDR A:0x1e0497c
y.create.l HWIO_APPS_SMMU_SSD_REG_608_APPS_ADDR A:0x1e04980
y.create.l HWIO_APPS_SMMU_SSD_REG_609_APPS_ADDR A:0x1e04984
y.create.l HWIO_APPS_SMMU_SSD_REG_610_APPS_ADDR A:0x1e04988
y.create.l HWIO_APPS_SMMU_SSD_REG_611_APPS_ADDR A:0x1e0498c
y.create.l HWIO_APPS_SMMU_SSD_REG_612_APPS_ADDR A:0x1e04990
y.create.l HWIO_APPS_SMMU_SSD_REG_613_APPS_ADDR A:0x1e04994
y.create.l HWIO_APPS_SMMU_SSD_REG_614_APPS_ADDR A:0x1e04998
y.create.l HWIO_APPS_SMMU_SSD_REG_615_APPS_ADDR A:0x1e0499c
y.create.l HWIO_APPS_SMMU_SSD_REG_616_APPS_ADDR A:0x1e049a0
y.create.l HWIO_APPS_SMMU_SSD_REG_617_APPS_ADDR A:0x1e049a4
y.create.l HWIO_APPS_SMMU_SSD_REG_618_APPS_ADDR A:0x1e049a8
y.create.l HWIO_APPS_SMMU_SSD_REG_619_APPS_ADDR A:0x1e049ac
y.create.l HWIO_APPS_SMMU_SSD_REG_620_APPS_ADDR A:0x1e049b0
y.create.l HWIO_APPS_SMMU_SSD_REG_621_APPS_ADDR A:0x1e049b4
y.create.l HWIO_APPS_SMMU_SSD_REG_622_APPS_ADDR A:0x1e049b8
y.create.l HWIO_APPS_SMMU_SSD_REG_623_APPS_ADDR A:0x1e049bc
y.create.l HWIO_APPS_SMMU_SSD_REG_624_APPS_ADDR A:0x1e049c0
y.create.l HWIO_APPS_SMMU_SSD_REG_625_APPS_ADDR A:0x1e049c4
y.create.l HWIO_APPS_SMMU_SSD_REG_626_APPS_ADDR A:0x1e049c8
y.create.l HWIO_APPS_SMMU_SSD_REG_627_APPS_ADDR A:0x1e049cc
y.create.l HWIO_APPS_SMMU_SSD_REG_628_APPS_ADDR A:0x1e049d0
y.create.l HWIO_APPS_SMMU_SSD_REG_629_APPS_ADDR A:0x1e049d4
y.create.l HWIO_APPS_SMMU_SSD_REG_630_APPS_ADDR A:0x1e049d8
y.create.l HWIO_APPS_SMMU_SSD_REG_631_APPS_ADDR A:0x1e049dc
y.create.l HWIO_APPS_SMMU_SSD_REG_632_APPS_ADDR A:0x1e049e0
y.create.l HWIO_APPS_SMMU_SSD_REG_633_APPS_ADDR A:0x1e049e4
y.create.l HWIO_APPS_SMMU_SSD_REG_634_APPS_ADDR A:0x1e049e8
y.create.l HWIO_APPS_SMMU_SSD_REG_635_APPS_ADDR A:0x1e049ec
y.create.l HWIO_APPS_SMMU_SSD_REG_636_APPS_ADDR A:0x1e049f0
y.create.l HWIO_APPS_SMMU_SSD_REG_637_APPS_ADDR A:0x1e049f4
y.create.l HWIO_APPS_SMMU_SSD_REG_638_APPS_ADDR A:0x1e049f8
y.create.l HWIO_APPS_SMMU_SSD_REG_639_APPS_ADDR A:0x1e049fc
y.create.l HWIO_APPS_SMMU_SSD_REG_640_APPS_ADDR A:0x1e04a00
y.create.l HWIO_APPS_SMMU_SSD_REG_641_APPS_ADDR A:0x1e04a04
y.create.l HWIO_APPS_SMMU_SSD_REG_642_APPS_ADDR A:0x1e04a08
y.create.l HWIO_APPS_SMMU_SSD_REG_643_APPS_ADDR A:0x1e04a0c
y.create.l HWIO_APPS_SMMU_SSD_REG_644_APPS_ADDR A:0x1e04a10
y.create.l HWIO_APPS_SMMU_SSD_REG_645_APPS_ADDR A:0x1e04a14
y.create.l HWIO_APPS_SMMU_SSD_REG_646_APPS_ADDR A:0x1e04a18
y.create.l HWIO_APPS_SMMU_SSD_REG_647_APPS_ADDR A:0x1e04a1c
y.create.l HWIO_APPS_SMMU_SSD_REG_648_APPS_ADDR A:0x1e04a20
y.create.l HWIO_APPS_SMMU_SSD_REG_649_APPS_ADDR A:0x1e04a24
y.create.l HWIO_APPS_SMMU_SSD_REG_650_APPS_ADDR A:0x1e04a28
y.create.l HWIO_APPS_SMMU_SSD_REG_651_APPS_ADDR A:0x1e04a2c
y.create.l HWIO_APPS_SMMU_SSD_REG_652_APPS_ADDR A:0x1e04a30
y.create.l HWIO_APPS_SMMU_SSD_REG_653_APPS_ADDR A:0x1e04a34
y.create.l HWIO_APPS_SMMU_SSD_REG_654_APPS_ADDR A:0x1e04a38
y.create.l HWIO_APPS_SMMU_SSD_REG_655_APPS_ADDR A:0x1e04a3c
y.create.l HWIO_APPS_SMMU_SSD_REG_656_APPS_ADDR A:0x1e04a40
y.create.l HWIO_APPS_SMMU_SSD_REG_657_APPS_ADDR A:0x1e04a44
y.create.l HWIO_APPS_SMMU_SSD_REG_658_APPS_ADDR A:0x1e04a48
y.create.l HWIO_APPS_SMMU_SSD_REG_659_APPS_ADDR A:0x1e04a4c
y.create.l HWIO_APPS_SMMU_SSD_REG_660_APPS_ADDR A:0x1e04a50
y.create.l HWIO_APPS_SMMU_SSD_REG_661_APPS_ADDR A:0x1e04a54
y.create.l HWIO_APPS_SMMU_SSD_REG_662_APPS_ADDR A:0x1e04a58
y.create.l HWIO_APPS_SMMU_SSD_REG_663_APPS_ADDR A:0x1e04a5c
y.create.l HWIO_APPS_SMMU_SSD_REG_664_APPS_ADDR A:0x1e04a60
y.create.l HWIO_APPS_SMMU_SSD_REG_665_APPS_ADDR A:0x1e04a64
y.create.l HWIO_APPS_SMMU_SSD_REG_666_APPS_ADDR A:0x1e04a68
y.create.l HWIO_APPS_SMMU_SSD_REG_667_APPS_ADDR A:0x1e04a6c
y.create.l HWIO_APPS_SMMU_SSD_REG_668_APPS_ADDR A:0x1e04a70
y.create.l HWIO_APPS_SMMU_SSD_REG_669_APPS_ADDR A:0x1e04a74
y.create.l HWIO_APPS_SMMU_SSD_REG_670_APPS_ADDR A:0x1e04a78
y.create.l HWIO_APPS_SMMU_SSD_REG_671_APPS_ADDR A:0x1e04a7c
y.create.l HWIO_APPS_SMMU_SSD_REG_672_APPS_ADDR A:0x1e04a80
y.create.l HWIO_APPS_SMMU_SSD_REG_673_APPS_ADDR A:0x1e04a84
y.create.l HWIO_APPS_SMMU_SSD_REG_674_APPS_ADDR A:0x1e04a88
y.create.l HWIO_APPS_SMMU_SSD_REG_675_APPS_ADDR A:0x1e04a8c
y.create.l HWIO_APPS_SMMU_SSD_REG_676_APPS_ADDR A:0x1e04a90
y.create.l HWIO_APPS_SMMU_SSD_REG_677_APPS_ADDR A:0x1e04a94
y.create.l HWIO_APPS_SMMU_SSD_REG_678_APPS_ADDR A:0x1e04a98
y.create.l HWIO_APPS_SMMU_SSD_REG_679_APPS_ADDR A:0x1e04a9c
y.create.l HWIO_APPS_SMMU_SSD_REG_680_APPS_ADDR A:0x1e04aa0
y.create.l HWIO_APPS_SMMU_SSD_REG_681_APPS_ADDR A:0x1e04aa4
y.create.l HWIO_APPS_SMMU_SSD_REG_682_APPS_ADDR A:0x1e04aa8
y.create.l HWIO_APPS_SMMU_SSD_REG_683_APPS_ADDR A:0x1e04aac
y.create.l HWIO_APPS_SMMU_SSD_REG_684_APPS_ADDR A:0x1e04ab0
y.create.l HWIO_APPS_SMMU_SSD_REG_685_APPS_ADDR A:0x1e04ab4
y.create.l HWIO_APPS_SMMU_SSD_REG_686_APPS_ADDR A:0x1e04ab8
y.create.l HWIO_APPS_SMMU_SSD_REG_687_APPS_ADDR A:0x1e04abc
y.create.l HWIO_APPS_SMMU_SSD_REG_688_APPS_ADDR A:0x1e04ac0
y.create.l HWIO_APPS_SMMU_SSD_REG_689_APPS_ADDR A:0x1e04ac4
y.create.l HWIO_APPS_SMMU_SSD_REG_690_APPS_ADDR A:0x1e04ac8
y.create.l HWIO_APPS_SMMU_SSD_REG_691_APPS_ADDR A:0x1e04acc
y.create.l HWIO_APPS_SMMU_SSD_REG_692_APPS_ADDR A:0x1e04ad0
y.create.l HWIO_APPS_SMMU_SSD_REG_693_APPS_ADDR A:0x1e04ad4
y.create.l HWIO_APPS_SMMU_SSD_REG_694_APPS_ADDR A:0x1e04ad8
y.create.l HWIO_APPS_SMMU_SSD_REG_695_APPS_ADDR A:0x1e04adc
y.create.l HWIO_APPS_SMMU_SSD_REG_696_APPS_ADDR A:0x1e04ae0
y.create.l HWIO_APPS_SMMU_SSD_REG_697_APPS_ADDR A:0x1e04ae4
y.create.l HWIO_APPS_SMMU_SSD_REG_698_APPS_ADDR A:0x1e04ae8
y.create.l HWIO_APPS_SMMU_SSD_REG_699_APPS_ADDR A:0x1e04aec
y.create.l HWIO_APPS_SMMU_SSD_REG_700_APPS_ADDR A:0x1e04af0
y.create.l HWIO_APPS_SMMU_SSD_REG_701_APPS_ADDR A:0x1e04af4
y.create.l HWIO_APPS_SMMU_SSD_REG_702_APPS_ADDR A:0x1e04af8
y.create.l HWIO_APPS_SMMU_SSD_REG_703_APPS_ADDR A:0x1e04afc
y.create.l HWIO_APPS_SMMU_SSD_REG_704_APPS_ADDR A:0x1e04b00
y.create.l HWIO_APPS_SMMU_SSD_REG_705_APPS_ADDR A:0x1e04b04
y.create.l HWIO_APPS_SMMU_SSD_REG_706_APPS_ADDR A:0x1e04b08
y.create.l HWIO_APPS_SMMU_SSD_REG_707_APPS_ADDR A:0x1e04b0c
y.create.l HWIO_APPS_SMMU_SSD_REG_708_APPS_ADDR A:0x1e04b10
y.create.l HWIO_APPS_SMMU_SSD_REG_709_APPS_ADDR A:0x1e04b14
y.create.l HWIO_APPS_SMMU_SSD_REG_710_APPS_ADDR A:0x1e04b18
y.create.l HWIO_APPS_SMMU_SSD_REG_711_APPS_ADDR A:0x1e04b1c
y.create.l HWIO_APPS_SMMU_SSD_REG_712_APPS_ADDR A:0x1e04b20
y.create.l HWIO_APPS_SMMU_SSD_REG_713_APPS_ADDR A:0x1e04b24
y.create.l HWIO_APPS_SMMU_SSD_REG_714_APPS_ADDR A:0x1e04b28
y.create.l HWIO_APPS_SMMU_SSD_REG_715_APPS_ADDR A:0x1e04b2c
y.create.l HWIO_APPS_SMMU_SSD_REG_716_APPS_ADDR A:0x1e04b30
y.create.l HWIO_APPS_SMMU_SSD_REG_717_APPS_ADDR A:0x1e04b34
y.create.l HWIO_APPS_SMMU_SSD_REG_718_APPS_ADDR A:0x1e04b38
y.create.l HWIO_APPS_SMMU_SSD_REG_719_APPS_ADDR A:0x1e04b3c
y.create.l HWIO_APPS_SMMU_SSD_REG_720_APPS_ADDR A:0x1e04b40
y.create.l HWIO_APPS_SMMU_SSD_REG_721_APPS_ADDR A:0x1e04b44
y.create.l HWIO_APPS_SMMU_SSD_REG_722_APPS_ADDR A:0x1e04b48
y.create.l HWIO_APPS_SMMU_SSD_REG_723_APPS_ADDR A:0x1e04b4c
y.create.l HWIO_APPS_SMMU_SSD_REG_724_APPS_ADDR A:0x1e04b50
y.create.l HWIO_APPS_SMMU_SSD_REG_725_APPS_ADDR A:0x1e04b54
y.create.l HWIO_APPS_SMMU_SSD_REG_726_APPS_ADDR A:0x1e04b58
y.create.l HWIO_APPS_SMMU_SSD_REG_727_APPS_ADDR A:0x1e04b5c
y.create.l HWIO_APPS_SMMU_SSD_REG_728_APPS_ADDR A:0x1e04b60
y.create.l HWIO_APPS_SMMU_SSD_REG_729_APPS_ADDR A:0x1e04b64
y.create.l HWIO_APPS_SMMU_SSD_REG_730_APPS_ADDR A:0x1e04b68
y.create.l HWIO_APPS_SMMU_SSD_REG_731_APPS_ADDR A:0x1e04b6c
y.create.l HWIO_APPS_SMMU_SSD_REG_732_APPS_ADDR A:0x1e04b70
y.create.l HWIO_APPS_SMMU_SSD_REG_733_APPS_ADDR A:0x1e04b74
y.create.l HWIO_APPS_SMMU_SSD_REG_734_APPS_ADDR A:0x1e04b78
y.create.l HWIO_APPS_SMMU_SSD_REG_735_APPS_ADDR A:0x1e04b7c
y.create.l HWIO_APPS_SMMU_SSD_REG_736_APPS_ADDR A:0x1e04b80
y.create.l HWIO_APPS_SMMU_SSD_REG_737_APPS_ADDR A:0x1e04b84
y.create.l HWIO_APPS_SMMU_SSD_REG_738_APPS_ADDR A:0x1e04b88
y.create.l HWIO_APPS_SMMU_SSD_REG_739_APPS_ADDR A:0x1e04b8c
y.create.l HWIO_APPS_SMMU_SSD_REG_740_APPS_ADDR A:0x1e04b90
y.create.l HWIO_APPS_SMMU_SSD_REG_741_APPS_ADDR A:0x1e04b94
y.create.l HWIO_APPS_SMMU_SSD_REG_742_APPS_ADDR A:0x1e04b98
y.create.l HWIO_APPS_SMMU_SSD_REG_743_APPS_ADDR A:0x1e04b9c
y.create.l HWIO_APPS_SMMU_SSD_REG_744_APPS_ADDR A:0x1e04ba0
y.create.l HWIO_APPS_SMMU_SSD_REG_745_APPS_ADDR A:0x1e04ba4
y.create.l HWIO_APPS_SMMU_SSD_REG_746_APPS_ADDR A:0x1e04ba8
y.create.l HWIO_APPS_SMMU_SSD_REG_747_APPS_ADDR A:0x1e04bac
y.create.l HWIO_APPS_SMMU_SSD_REG_748_APPS_ADDR A:0x1e04bb0
y.create.l HWIO_APPS_SMMU_SSD_REG_749_APPS_ADDR A:0x1e04bb4
y.create.l HWIO_APPS_SMMU_SSD_REG_750_APPS_ADDR A:0x1e04bb8
y.create.l HWIO_APPS_SMMU_SSD_REG_751_APPS_ADDR A:0x1e04bbc
y.create.l HWIO_APPS_SMMU_SSD_REG_752_APPS_ADDR A:0x1e04bc0
y.create.l HWIO_APPS_SMMU_SSD_REG_753_APPS_ADDR A:0x1e04bc4
y.create.l HWIO_APPS_SMMU_SSD_REG_754_APPS_ADDR A:0x1e04bc8
y.create.l HWIO_APPS_SMMU_SSD_REG_755_APPS_ADDR A:0x1e04bcc
y.create.l HWIO_APPS_SMMU_SSD_REG_756_APPS_ADDR A:0x1e04bd0
y.create.l HWIO_APPS_SMMU_SSD_REG_757_APPS_ADDR A:0x1e04bd4
y.create.l HWIO_APPS_SMMU_SSD_REG_758_APPS_ADDR A:0x1e04bd8
y.create.l HWIO_APPS_SMMU_SSD_REG_759_APPS_ADDR A:0x1e04bdc
y.create.l HWIO_APPS_SMMU_SSD_REG_760_APPS_ADDR A:0x1e04be0
y.create.l HWIO_APPS_SMMU_SSD_REG_761_APPS_ADDR A:0x1e04be4
y.create.l HWIO_APPS_SMMU_SSD_REG_762_APPS_ADDR A:0x1e04be8
y.create.l HWIO_APPS_SMMU_SSD_REG_763_APPS_ADDR A:0x1e04bec
y.create.l HWIO_APPS_SMMU_SSD_REG_764_APPS_ADDR A:0x1e04bf0
y.create.l HWIO_APPS_SMMU_SSD_REG_765_APPS_ADDR A:0x1e04bf4
y.create.l HWIO_APPS_SMMU_SSD_REG_766_APPS_ADDR A:0x1e04bf8
y.create.l HWIO_APPS_SMMU_SSD_REG_767_APPS_ADDR A:0x1e04bfc
y.create.l HWIO_APPS_SMMU_SSD_REG_768_APPS_ADDR A:0x1e04c00
y.create.l HWIO_APPS_SMMU_SSD_REG_769_APPS_ADDR A:0x1e04c04
y.create.l HWIO_APPS_SMMU_SSD_REG_770_APPS_ADDR A:0x1e04c08
y.create.l HWIO_APPS_SMMU_SSD_REG_771_APPS_ADDR A:0x1e04c0c
y.create.l HWIO_APPS_SMMU_SSD_REG_772_APPS_ADDR A:0x1e04c10
y.create.l HWIO_APPS_SMMU_SSD_REG_773_APPS_ADDR A:0x1e04c14
y.create.l HWIO_APPS_SMMU_SSD_REG_774_APPS_ADDR A:0x1e04c18
y.create.l HWIO_APPS_SMMU_SSD_REG_775_APPS_ADDR A:0x1e04c1c
y.create.l HWIO_APPS_SMMU_SSD_REG_776_APPS_ADDR A:0x1e04c20
y.create.l HWIO_APPS_SMMU_SSD_REG_777_APPS_ADDR A:0x1e04c24
y.create.l HWIO_APPS_SMMU_SSD_REG_778_APPS_ADDR A:0x1e04c28
y.create.l HWIO_APPS_SMMU_SSD_REG_779_APPS_ADDR A:0x1e04c2c
y.create.l HWIO_APPS_SMMU_SSD_REG_780_APPS_ADDR A:0x1e04c30
y.create.l HWIO_APPS_SMMU_SSD_REG_781_APPS_ADDR A:0x1e04c34
y.create.l HWIO_APPS_SMMU_SSD_REG_782_APPS_ADDR A:0x1e04c38
y.create.l HWIO_APPS_SMMU_SSD_REG_783_APPS_ADDR A:0x1e04c3c
y.create.l HWIO_APPS_SMMU_SSD_REG_784_APPS_ADDR A:0x1e04c40
y.create.l HWIO_APPS_SMMU_SSD_REG_785_APPS_ADDR A:0x1e04c44
y.create.l HWIO_APPS_SMMU_SSD_REG_786_APPS_ADDR A:0x1e04c48
y.create.l HWIO_APPS_SMMU_SSD_REG_787_APPS_ADDR A:0x1e04c4c
y.create.l HWIO_APPS_SMMU_SSD_REG_788_APPS_ADDR A:0x1e04c50
y.create.l HWIO_APPS_SMMU_SSD_REG_789_APPS_ADDR A:0x1e04c54
y.create.l HWIO_APPS_SMMU_SSD_REG_790_APPS_ADDR A:0x1e04c58
y.create.l HWIO_APPS_SMMU_SSD_REG_791_APPS_ADDR A:0x1e04c5c
y.create.l HWIO_APPS_SMMU_SSD_REG_792_APPS_ADDR A:0x1e04c60
y.create.l HWIO_APPS_SMMU_SSD_REG_793_APPS_ADDR A:0x1e04c64
y.create.l HWIO_APPS_SMMU_SSD_REG_794_APPS_ADDR A:0x1e04c68
y.create.l HWIO_APPS_SMMU_SSD_REG_795_APPS_ADDR A:0x1e04c6c
y.create.l HWIO_APPS_SMMU_SSD_REG_796_APPS_ADDR A:0x1e04c70
y.create.l HWIO_APPS_SMMU_SSD_REG_797_APPS_ADDR A:0x1e04c74
y.create.l HWIO_APPS_SMMU_SSD_REG_798_APPS_ADDR A:0x1e04c78
y.create.l HWIO_APPS_SMMU_SSD_REG_799_APPS_ADDR A:0x1e04c7c
y.create.l HWIO_APPS_SMMU_SSD_REG_800_APPS_ADDR A:0x1e04c80
y.create.l HWIO_APPS_SMMU_SSD_REG_801_APPS_ADDR A:0x1e04c84
y.create.l HWIO_APPS_SMMU_SSD_REG_802_APPS_ADDR A:0x1e04c88
y.create.l HWIO_APPS_SMMU_SSD_REG_803_APPS_ADDR A:0x1e04c8c
y.create.l HWIO_APPS_SMMU_SSD_REG_804_APPS_ADDR A:0x1e04c90
y.create.l HWIO_APPS_SMMU_SSD_REG_805_APPS_ADDR A:0x1e04c94
y.create.l HWIO_APPS_SMMU_SSD_REG_806_APPS_ADDR A:0x1e04c98
y.create.l HWIO_APPS_SMMU_SSD_REG_807_APPS_ADDR A:0x1e04c9c
y.create.l HWIO_APPS_SMMU_SSD_REG_808_APPS_ADDR A:0x1e04ca0
y.create.l HWIO_APPS_SMMU_SSD_REG_809_APPS_ADDR A:0x1e04ca4
y.create.l HWIO_APPS_SMMU_SSD_REG_810_APPS_ADDR A:0x1e04ca8
y.create.l HWIO_APPS_SMMU_SSD_REG_811_APPS_ADDR A:0x1e04cac
y.create.l HWIO_APPS_SMMU_SSD_REG_812_APPS_ADDR A:0x1e04cb0
y.create.l HWIO_APPS_SMMU_SSD_REG_813_APPS_ADDR A:0x1e04cb4
y.create.l HWIO_APPS_SMMU_SSD_REG_814_APPS_ADDR A:0x1e04cb8
y.create.l HWIO_APPS_SMMU_SSD_REG_815_APPS_ADDR A:0x1e04cbc
y.create.l HWIO_APPS_SMMU_SSD_REG_816_APPS_ADDR A:0x1e04cc0
y.create.l HWIO_APPS_SMMU_SSD_REG_817_APPS_ADDR A:0x1e04cc4
y.create.l HWIO_APPS_SMMU_SSD_REG_818_APPS_ADDR A:0x1e04cc8
y.create.l HWIO_APPS_SMMU_SSD_REG_819_APPS_ADDR A:0x1e04ccc
y.create.l HWIO_APPS_SMMU_SSD_REG_820_APPS_ADDR A:0x1e04cd0
y.create.l HWIO_APPS_SMMU_SSD_REG_821_APPS_ADDR A:0x1e04cd4
y.create.l HWIO_APPS_SMMU_SSD_REG_822_APPS_ADDR A:0x1e04cd8
y.create.l HWIO_APPS_SMMU_SSD_REG_823_APPS_ADDR A:0x1e04cdc
y.create.l HWIO_APPS_SMMU_SSD_REG_824_APPS_ADDR A:0x1e04ce0
y.create.l HWIO_APPS_SMMU_SSD_REG_825_APPS_ADDR A:0x1e04ce4
y.create.l HWIO_APPS_SMMU_SSD_REG_826_APPS_ADDR A:0x1e04ce8
y.create.l HWIO_APPS_SMMU_SSD_REG_827_APPS_ADDR A:0x1e04cec
y.create.l HWIO_APPS_SMMU_SSD_REG_828_APPS_ADDR A:0x1e04cf0
y.create.l HWIO_APPS_SMMU_SSD_REG_829_APPS_ADDR A:0x1e04cf4
y.create.l HWIO_APPS_SMMU_SSD_REG_830_APPS_ADDR A:0x1e04cf8
y.create.l HWIO_APPS_SMMU_SSD_REG_831_APPS_ADDR A:0x1e04cfc
y.create.l HWIO_APPS_SMMU_SSD_REG_832_APPS_ADDR A:0x1e04d00
y.create.l HWIO_APPS_SMMU_SSD_REG_833_APPS_ADDR A:0x1e04d04
y.create.l HWIO_APPS_SMMU_SSD_REG_834_APPS_ADDR A:0x1e04d08
y.create.l HWIO_APPS_SMMU_SSD_REG_835_APPS_ADDR A:0x1e04d0c
y.create.l HWIO_APPS_SMMU_SSD_REG_836_APPS_ADDR A:0x1e04d10
y.create.l HWIO_APPS_SMMU_SSD_REG_837_APPS_ADDR A:0x1e04d14
y.create.l HWIO_APPS_SMMU_SSD_REG_838_APPS_ADDR A:0x1e04d18
y.create.l HWIO_APPS_SMMU_SSD_REG_839_APPS_ADDR A:0x1e04d1c
y.create.l HWIO_APPS_SMMU_SSD_REG_840_APPS_ADDR A:0x1e04d20
y.create.l HWIO_APPS_SMMU_SSD_REG_841_APPS_ADDR A:0x1e04d24
y.create.l HWIO_APPS_SMMU_SSD_REG_842_APPS_ADDR A:0x1e04d28
y.create.l HWIO_APPS_SMMU_SSD_REG_843_APPS_ADDR A:0x1e04d2c
y.create.l HWIO_APPS_SMMU_SSD_REG_844_APPS_ADDR A:0x1e04d30
y.create.l HWIO_APPS_SMMU_SSD_REG_845_APPS_ADDR A:0x1e04d34
y.create.l HWIO_APPS_SMMU_SSD_REG_846_APPS_ADDR A:0x1e04d38
y.create.l HWIO_APPS_SMMU_SSD_REG_847_APPS_ADDR A:0x1e04d3c
y.create.l HWIO_APPS_SMMU_SSD_REG_848_APPS_ADDR A:0x1e04d40
y.create.l HWIO_APPS_SMMU_SSD_REG_849_APPS_ADDR A:0x1e04d44
y.create.l HWIO_APPS_SMMU_SSD_REG_850_APPS_ADDR A:0x1e04d48
y.create.l HWIO_APPS_SMMU_SSD_REG_851_APPS_ADDR A:0x1e04d4c
y.create.l HWIO_APPS_SMMU_SSD_REG_852_APPS_ADDR A:0x1e04d50
y.create.l HWIO_APPS_SMMU_SSD_REG_853_APPS_ADDR A:0x1e04d54
y.create.l HWIO_APPS_SMMU_SSD_REG_854_APPS_ADDR A:0x1e04d58
y.create.l HWIO_APPS_SMMU_SSD_REG_855_APPS_ADDR A:0x1e04d5c
y.create.l HWIO_APPS_SMMU_SSD_REG_856_APPS_ADDR A:0x1e04d60
y.create.l HWIO_APPS_SMMU_SSD_REG_857_APPS_ADDR A:0x1e04d64
y.create.l HWIO_APPS_SMMU_SSD_REG_858_APPS_ADDR A:0x1e04d68
y.create.l HWIO_APPS_SMMU_SSD_REG_859_APPS_ADDR A:0x1e04d6c
y.create.l HWIO_APPS_SMMU_SSD_REG_860_APPS_ADDR A:0x1e04d70
y.create.l HWIO_APPS_SMMU_SSD_REG_861_APPS_ADDR A:0x1e04d74
y.create.l HWIO_APPS_SMMU_SSD_REG_862_APPS_ADDR A:0x1e04d78
y.create.l HWIO_APPS_SMMU_SSD_REG_863_APPS_ADDR A:0x1e04d7c
y.create.l HWIO_APPS_SMMU_SSD_REG_864_APPS_ADDR A:0x1e04d80
y.create.l HWIO_APPS_SMMU_SSD_REG_865_APPS_ADDR A:0x1e04d84
y.create.l HWIO_APPS_SMMU_SSD_REG_866_APPS_ADDR A:0x1e04d88
y.create.l HWIO_APPS_SMMU_SSD_REG_867_APPS_ADDR A:0x1e04d8c
y.create.l HWIO_APPS_SMMU_SSD_REG_868_APPS_ADDR A:0x1e04d90
y.create.l HWIO_APPS_SMMU_SSD_REG_869_APPS_ADDR A:0x1e04d94
y.create.l HWIO_APPS_SMMU_SSD_REG_870_APPS_ADDR A:0x1e04d98
y.create.l HWIO_APPS_SMMU_SSD_REG_871_APPS_ADDR A:0x1e04d9c
y.create.l HWIO_APPS_SMMU_SSD_REG_872_APPS_ADDR A:0x1e04da0
y.create.l HWIO_APPS_SMMU_SSD_REG_873_APPS_ADDR A:0x1e04da4
y.create.l HWIO_APPS_SMMU_SSD_REG_874_APPS_ADDR A:0x1e04da8
y.create.l HWIO_APPS_SMMU_SSD_REG_875_APPS_ADDR A:0x1e04dac
y.create.l HWIO_APPS_SMMU_SSD_REG_876_APPS_ADDR A:0x1e04db0
y.create.l HWIO_APPS_SMMU_SSD_REG_877_APPS_ADDR A:0x1e04db4
y.create.l HWIO_APPS_SMMU_SSD_REG_878_APPS_ADDR A:0x1e04db8
y.create.l HWIO_APPS_SMMU_SSD_REG_879_APPS_ADDR A:0x1e04dbc
y.create.l HWIO_APPS_SMMU_SSD_REG_880_APPS_ADDR A:0x1e04dc0
y.create.l HWIO_APPS_SMMU_SSD_REG_881_APPS_ADDR A:0x1e04dc4
y.create.l HWIO_APPS_SMMU_SSD_REG_882_APPS_ADDR A:0x1e04dc8
y.create.l HWIO_APPS_SMMU_SSD_REG_883_APPS_ADDR A:0x1e04dcc
y.create.l HWIO_APPS_SMMU_SSD_REG_884_APPS_ADDR A:0x1e04dd0
y.create.l HWIO_APPS_SMMU_SSD_REG_885_APPS_ADDR A:0x1e04dd4
y.create.l HWIO_APPS_SMMU_SSD_REG_886_APPS_ADDR A:0x1e04dd8
y.create.l HWIO_APPS_SMMU_SSD_REG_887_APPS_ADDR A:0x1e04ddc
y.create.l HWIO_APPS_SMMU_SSD_REG_888_APPS_ADDR A:0x1e04de0
y.create.l HWIO_APPS_SMMU_SSD_REG_889_APPS_ADDR A:0x1e04de4
y.create.l HWIO_APPS_SMMU_SSD_REG_890_APPS_ADDR A:0x1e04de8
y.create.l HWIO_APPS_SMMU_SSD_REG_891_APPS_ADDR A:0x1e04dec
y.create.l HWIO_APPS_SMMU_SSD_REG_892_APPS_ADDR A:0x1e04df0
y.create.l HWIO_APPS_SMMU_SSD_REG_893_APPS_ADDR A:0x1e04df4
y.create.l HWIO_APPS_SMMU_SSD_REG_894_APPS_ADDR A:0x1e04df8
y.create.l HWIO_APPS_SMMU_SSD_REG_895_APPS_ADDR A:0x1e04dfc
y.create.l HWIO_APPS_SMMU_SSD_REG_896_APPS_ADDR A:0x1e04e00
y.create.l HWIO_APPS_SMMU_SSD_REG_897_APPS_ADDR A:0x1e04e04
y.create.l HWIO_APPS_SMMU_SSD_REG_898_APPS_ADDR A:0x1e04e08
y.create.l HWIO_APPS_SMMU_SSD_REG_899_APPS_ADDR A:0x1e04e0c
y.create.l HWIO_APPS_SMMU_SSD_REG_900_APPS_ADDR A:0x1e04e10
y.create.l HWIO_APPS_SMMU_SSD_REG_901_APPS_ADDR A:0x1e04e14
y.create.l HWIO_APPS_SMMU_SSD_REG_902_APPS_ADDR A:0x1e04e18
y.create.l HWIO_APPS_SMMU_SSD_REG_903_APPS_ADDR A:0x1e04e1c
y.create.l HWIO_APPS_SMMU_SSD_REG_904_APPS_ADDR A:0x1e04e20
y.create.l HWIO_APPS_SMMU_SSD_REG_905_APPS_ADDR A:0x1e04e24
y.create.l HWIO_APPS_SMMU_SSD_REG_906_APPS_ADDR A:0x1e04e28
y.create.l HWIO_APPS_SMMU_SSD_REG_907_APPS_ADDR A:0x1e04e2c
y.create.l HWIO_APPS_SMMU_SSD_REG_908_APPS_ADDR A:0x1e04e30
y.create.l HWIO_APPS_SMMU_SSD_REG_909_APPS_ADDR A:0x1e04e34
y.create.l HWIO_APPS_SMMU_SSD_REG_910_APPS_ADDR A:0x1e04e38
y.create.l HWIO_APPS_SMMU_SSD_REG_911_APPS_ADDR A:0x1e04e3c
y.create.l HWIO_APPS_SMMU_SSD_REG_912_APPS_ADDR A:0x1e04e40
y.create.l HWIO_APPS_SMMU_SSD_REG_913_APPS_ADDR A:0x1e04e44
y.create.l HWIO_APPS_SMMU_SSD_REG_914_APPS_ADDR A:0x1e04e48
y.create.l HWIO_APPS_SMMU_SSD_REG_915_APPS_ADDR A:0x1e04e4c
y.create.l HWIO_APPS_SMMU_SSD_REG_916_APPS_ADDR A:0x1e04e50
y.create.l HWIO_APPS_SMMU_SSD_REG_917_APPS_ADDR A:0x1e04e54
y.create.l HWIO_APPS_SMMU_SSD_REG_918_APPS_ADDR A:0x1e04e58
y.create.l HWIO_APPS_SMMU_SSD_REG_919_APPS_ADDR A:0x1e04e5c
y.create.l HWIO_APPS_SMMU_SSD_REG_920_APPS_ADDR A:0x1e04e60
y.create.l HWIO_APPS_SMMU_SSD_REG_921_APPS_ADDR A:0x1e04e64
y.create.l HWIO_APPS_SMMU_SSD_REG_922_APPS_ADDR A:0x1e04e68
y.create.l HWIO_APPS_SMMU_SSD_REG_923_APPS_ADDR A:0x1e04e6c
y.create.l HWIO_APPS_SMMU_SSD_REG_924_APPS_ADDR A:0x1e04e70
y.create.l HWIO_APPS_SMMU_SSD_REG_925_APPS_ADDR A:0x1e04e74
y.create.l HWIO_APPS_SMMU_SSD_REG_926_APPS_ADDR A:0x1e04e78
y.create.l HWIO_APPS_SMMU_SSD_REG_927_APPS_ADDR A:0x1e04e7c
y.create.l HWIO_APPS_SMMU_SSD_REG_928_APPS_ADDR A:0x1e04e80
y.create.l HWIO_APPS_SMMU_SSD_REG_929_APPS_ADDR A:0x1e04e84
y.create.l HWIO_APPS_SMMU_SSD_REG_930_APPS_ADDR A:0x1e04e88
y.create.l HWIO_APPS_SMMU_SSD_REG_931_APPS_ADDR A:0x1e04e8c
y.create.l HWIO_APPS_SMMU_SSD_REG_932_APPS_ADDR A:0x1e04e90
y.create.l HWIO_APPS_SMMU_SSD_REG_933_APPS_ADDR A:0x1e04e94
y.create.l HWIO_APPS_SMMU_SSD_REG_934_APPS_ADDR A:0x1e04e98
y.create.l HWIO_APPS_SMMU_SSD_REG_935_APPS_ADDR A:0x1e04e9c
y.create.l HWIO_APPS_SMMU_SSD_REG_936_APPS_ADDR A:0x1e04ea0
y.create.l HWIO_APPS_SMMU_SSD_REG_937_APPS_ADDR A:0x1e04ea4
y.create.l HWIO_APPS_SMMU_SSD_REG_938_APPS_ADDR A:0x1e04ea8
y.create.l HWIO_APPS_SMMU_SSD_REG_939_APPS_ADDR A:0x1e04eac
y.create.l HWIO_APPS_SMMU_SSD_REG_940_APPS_ADDR A:0x1e04eb0
y.create.l HWIO_APPS_SMMU_SSD_REG_941_APPS_ADDR A:0x1e04eb4
y.create.l HWIO_APPS_SMMU_SSD_REG_942_APPS_ADDR A:0x1e04eb8
y.create.l HWIO_APPS_SMMU_SSD_REG_943_APPS_ADDR A:0x1e04ebc
y.create.l HWIO_APPS_SMMU_SSD_REG_944_APPS_ADDR A:0x1e04ec0
y.create.l HWIO_APPS_SMMU_SSD_REG_945_APPS_ADDR A:0x1e04ec4
y.create.l HWIO_APPS_SMMU_SSD_REG_946_APPS_ADDR A:0x1e04ec8
y.create.l HWIO_APPS_SMMU_SSD_REG_947_APPS_ADDR A:0x1e04ecc
y.create.l HWIO_APPS_SMMU_SSD_REG_948_APPS_ADDR A:0x1e04ed0
y.create.l HWIO_APPS_SMMU_SSD_REG_949_APPS_ADDR A:0x1e04ed4
y.create.l HWIO_APPS_SMMU_SSD_REG_950_APPS_ADDR A:0x1e04ed8
y.create.l HWIO_APPS_SMMU_SSD_REG_951_APPS_ADDR A:0x1e04edc
y.create.l HWIO_APPS_SMMU_SSD_REG_952_APPS_ADDR A:0x1e04ee0
y.create.l HWIO_APPS_SMMU_SSD_REG_953_APPS_ADDR A:0x1e04ee4
y.create.l HWIO_APPS_SMMU_SSD_REG_954_APPS_ADDR A:0x1e04ee8
y.create.l HWIO_APPS_SMMU_SSD_REG_955_APPS_ADDR A:0x1e04eec
y.create.l HWIO_APPS_SMMU_SSD_REG_956_APPS_ADDR A:0x1e04ef0
y.create.l HWIO_APPS_SMMU_SSD_REG_957_APPS_ADDR A:0x1e04ef4
y.create.l HWIO_APPS_SMMU_SSD_REG_958_APPS_ADDR A:0x1e04ef8
y.create.l HWIO_APPS_SMMU_SSD_REG_959_APPS_ADDR A:0x1e04efc
y.create.l HWIO_APPS_SMMU_SSD_REG_960_APPS_ADDR A:0x1e04f00
y.create.l HWIO_APPS_SMMU_SSD_REG_961_APPS_ADDR A:0x1e04f04
y.create.l HWIO_APPS_SMMU_SSD_REG_962_APPS_ADDR A:0x1e04f08
y.create.l HWIO_APPS_SMMU_SSD_REG_963_APPS_ADDR A:0x1e04f0c
y.create.l HWIO_APPS_SMMU_SSD_REG_964_APPS_ADDR A:0x1e04f10
y.create.l HWIO_APPS_SMMU_SSD_REG_965_APPS_ADDR A:0x1e04f14
y.create.l HWIO_APPS_SMMU_SSD_REG_966_APPS_ADDR A:0x1e04f18
y.create.l HWIO_APPS_SMMU_SSD_REG_967_APPS_ADDR A:0x1e04f1c
y.create.l HWIO_APPS_SMMU_SSD_REG_968_APPS_ADDR A:0x1e04f20
y.create.l HWIO_APPS_SMMU_SSD_REG_969_APPS_ADDR A:0x1e04f24
y.create.l HWIO_APPS_SMMU_SSD_REG_970_APPS_ADDR A:0x1e04f28
y.create.l HWIO_APPS_SMMU_SSD_REG_971_APPS_ADDR A:0x1e04f2c
y.create.l HWIO_APPS_SMMU_SSD_REG_972_APPS_ADDR A:0x1e04f30
y.create.l HWIO_APPS_SMMU_SSD_REG_973_APPS_ADDR A:0x1e04f34
y.create.l HWIO_APPS_SMMU_SSD_REG_974_APPS_ADDR A:0x1e04f38
y.create.l HWIO_APPS_SMMU_SSD_REG_975_APPS_ADDR A:0x1e04f3c
y.create.l HWIO_APPS_SMMU_SSD_REG_976_APPS_ADDR A:0x1e04f40
y.create.l HWIO_APPS_SMMU_SSD_REG_977_APPS_ADDR A:0x1e04f44
y.create.l HWIO_APPS_SMMU_SSD_REG_978_APPS_ADDR A:0x1e04f48
y.create.l HWIO_APPS_SMMU_SSD_REG_979_APPS_ADDR A:0x1e04f4c
y.create.l HWIO_APPS_SMMU_SSD_REG_980_APPS_ADDR A:0x1e04f50
y.create.l HWIO_APPS_SMMU_SSD_REG_981_APPS_ADDR A:0x1e04f54
y.create.l HWIO_APPS_SMMU_SSD_REG_982_APPS_ADDR A:0x1e04f58
y.create.l HWIO_APPS_SMMU_SSD_REG_983_APPS_ADDR A:0x1e04f5c
y.create.l HWIO_APPS_SMMU_SSD_REG_984_APPS_ADDR A:0x1e04f60
y.create.l HWIO_APPS_SMMU_SSD_REG_985_APPS_ADDR A:0x1e04f64
y.create.l HWIO_APPS_SMMU_SSD_REG_986_APPS_ADDR A:0x1e04f68
y.create.l HWIO_APPS_SMMU_SSD_REG_987_APPS_ADDR A:0x1e04f6c
y.create.l HWIO_APPS_SMMU_SSD_REG_988_APPS_ADDR A:0x1e04f70
y.create.l HWIO_APPS_SMMU_SSD_REG_989_APPS_ADDR A:0x1e04f74
y.create.l HWIO_APPS_SMMU_SSD_REG_990_APPS_ADDR A:0x1e04f78
y.create.l HWIO_APPS_SMMU_SSD_REG_991_APPS_ADDR A:0x1e04f7c
y.create.l HWIO_APPS_SMMU_SSD_REG_992_APPS_ADDR A:0x1e04f80
y.create.l HWIO_APPS_SMMU_SSD_REG_993_APPS_ADDR A:0x1e04f84
y.create.l HWIO_APPS_SMMU_SSD_REG_994_APPS_ADDR A:0x1e04f88
y.create.l HWIO_APPS_SMMU_SSD_REG_995_APPS_ADDR A:0x1e04f8c
y.create.l HWIO_APPS_SMMU_SSD_REG_996_APPS_ADDR A:0x1e04f90
y.create.l HWIO_APPS_SMMU_SSD_REG_997_APPS_ADDR A:0x1e04f94
y.create.l HWIO_APPS_SMMU_SSD_REG_998_APPS_ADDR A:0x1e04f98
y.create.l HWIO_APPS_SMMU_SSD_REG_999_APPS_ADDR A:0x1e04f9c
y.create.l HWIO_APPS_SMMU_SSD_REG_1000_APPS_ADDR A:0x1e04fa0
y.create.l HWIO_APPS_SMMU_SSD_REG_1001_APPS_ADDR A:0x1e04fa4
y.create.l HWIO_APPS_SMMU_SSD_REG_1002_APPS_ADDR A:0x1e04fa8
y.create.l HWIO_APPS_SMMU_SSD_REG_1003_APPS_ADDR A:0x1e04fac
y.create.l HWIO_APPS_SMMU_SSD_REG_1004_APPS_ADDR A:0x1e04fb0
y.create.l HWIO_APPS_SMMU_SSD_REG_1005_APPS_ADDR A:0x1e04fb4
y.create.l HWIO_APPS_SMMU_SSD_REG_1006_APPS_ADDR A:0x1e04fb8
y.create.l HWIO_APPS_SMMU_SSD_REG_1007_APPS_ADDR A:0x1e04fbc
y.create.l HWIO_APPS_SMMU_SSD_REG_1008_APPS_ADDR A:0x1e04fc0
y.create.l HWIO_APPS_SMMU_SSD_REG_1009_APPS_ADDR A:0x1e04fc4
y.create.l HWIO_APPS_SMMU_SSD_REG_1010_APPS_ADDR A:0x1e04fc8
y.create.l HWIO_APPS_SMMU_SSD_REG_1011_APPS_ADDR A:0x1e04fcc
y.create.l HWIO_APPS_SMMU_SSD_REG_1012_APPS_ADDR A:0x1e04fd0
y.create.l HWIO_APPS_SMMU_SSD_REG_1013_APPS_ADDR A:0x1e04fd4
y.create.l HWIO_APPS_SMMU_SSD_REG_1014_APPS_ADDR A:0x1e04fd8
y.create.l HWIO_APPS_SMMU_SSD_REG_1015_APPS_ADDR A:0x1e04fdc
y.create.l HWIO_APPS_SMMU_SSD_REG_1016_APPS_ADDR A:0x1e04fe0
y.create.l HWIO_APPS_SMMU_SSD_REG_1017_APPS_ADDR A:0x1e04fe4
y.create.l HWIO_APPS_SMMU_SSD_REG_1018_APPS_ADDR A:0x1e04fe8
y.create.l HWIO_APPS_SMMU_SSD_REG_1019_APPS_ADDR A:0x1e04fec
y.create.l HWIO_APPS_SMMU_SSD_REG_1020_APPS_ADDR A:0x1e04ff0
y.create.l HWIO_APPS_SMMU_SSD_REG_1021_APPS_ADDR A:0x1e04ff4
y.create.l HWIO_APPS_SMMU_SSD_REG_1022_APPS_ADDR A:0x1e04ff8
y.create.l HWIO_APPS_SMMU_SSD_REG_1023_APPS_ADDR A:0x1e04ffc
y.create.l HWIO_APPS_SMMU_CB0_SCTLR_APPS_ADDR A:0x1e20000
y.create.l HWIO_APPS_SMMU_CB1_SCTLR_APPS_ADDR A:0x1e21000
y.create.l HWIO_APPS_SMMU_CB2_SCTLR_APPS_ADDR A:0x1e22000
y.create.l HWIO_APPS_SMMU_CB3_SCTLR_APPS_ADDR A:0x1e23000
y.create.l HWIO_APPS_SMMU_CB4_SCTLR_APPS_ADDR A:0x1e24000
y.create.l HWIO_APPS_SMMU_CB5_SCTLR_APPS_ADDR A:0x1e25000
y.create.l HWIO_APPS_SMMU_CB6_SCTLR_APPS_ADDR A:0x1e26000
y.create.l HWIO_APPS_SMMU_CB7_SCTLR_APPS_ADDR A:0x1e27000
y.create.l HWIO_APPS_SMMU_CB8_SCTLR_APPS_ADDR A:0x1e28000
y.create.l HWIO_APPS_SMMU_CB9_SCTLR_APPS_ADDR A:0x1e29000
y.create.l HWIO_APPS_SMMU_CB10_SCTLR_APPS_ADDR A:0x1e2a000
y.create.l HWIO_APPS_SMMU_CB11_SCTLR_APPS_ADDR A:0x1e2b000
y.create.l HWIO_APPS_SMMU_CB12_SCTLR_APPS_ADDR A:0x1e2c000
y.create.l HWIO_APPS_SMMU_CB13_SCTLR_APPS_ADDR A:0x1e2d000
y.create.l HWIO_APPS_SMMU_CB14_SCTLR_APPS_ADDR A:0x1e2e000
y.create.l HWIO_APPS_SMMU_CB15_SCTLR_APPS_ADDR A:0x1e2f000
y.create.l HWIO_APPS_SMMU_CB16_SCTLR_APPS_ADDR A:0x1e30000
y.create.l HWIO_APPS_SMMU_CB17_SCTLR_APPS_ADDR A:0x1e31000
y.create.l HWIO_APPS_SMMU_CB18_SCTLR_APPS_ADDR A:0x1e32000
y.create.l HWIO_APPS_SMMU_CB19_SCTLR_APPS_ADDR A:0x1e33000
y.create.l HWIO_APPS_SMMU_CB20_SCTLR_APPS_ADDR A:0x1e34000
y.create.l HWIO_APPS_SMMU_CB21_SCTLR_APPS_ADDR A:0x1e35000
y.create.l HWIO_APPS_SMMU_CB22_SCTLR_APPS_ADDR A:0x1e36000
y.create.l HWIO_APPS_SMMU_CB23_SCTLR_APPS_ADDR A:0x1e37000
y.create.l HWIO_APPS_SMMU_CB24_SCTLR_APPS_ADDR A:0x1e38000
y.create.l HWIO_APPS_SMMU_CB25_SCTLR_APPS_ADDR A:0x1e39000
y.create.l HWIO_APPS_SMMU_CB26_SCTLR_APPS_ADDR A:0x1e3a000
y.create.l HWIO_APPS_SMMU_CB27_SCTLR_APPS_ADDR A:0x1e3b000
y.create.l HWIO_APPS_SMMU_CB28_SCTLR_APPS_ADDR A:0x1e3c000
y.create.l HWIO_APPS_SMMU_CB29_SCTLR_APPS_ADDR A:0x1e3d000
y.create.l HWIO_APPS_SMMU_CB30_SCTLR_APPS_ADDR A:0x1e3e000
y.create.l HWIO_APPS_SMMU_CB31_SCTLR_APPS_ADDR A:0x1e3f000
y.create.l HWIO_APPS_SMMU_CB0_ACTLR_APPS_ADDR A:0x1e20004
y.create.l HWIO_APPS_SMMU_CB1_ACTLR_APPS_ADDR A:0x1e21004
y.create.l HWIO_APPS_SMMU_CB2_ACTLR_APPS_ADDR A:0x1e22004
y.create.l HWIO_APPS_SMMU_CB3_ACTLR_APPS_ADDR A:0x1e23004
y.create.l HWIO_APPS_SMMU_CB4_ACTLR_APPS_ADDR A:0x1e24004
y.create.l HWIO_APPS_SMMU_CB5_ACTLR_APPS_ADDR A:0x1e25004
y.create.l HWIO_APPS_SMMU_CB6_ACTLR_APPS_ADDR A:0x1e26004
y.create.l HWIO_APPS_SMMU_CB7_ACTLR_APPS_ADDR A:0x1e27004
y.create.l HWIO_APPS_SMMU_CB8_ACTLR_APPS_ADDR A:0x1e28004
y.create.l HWIO_APPS_SMMU_CB9_ACTLR_APPS_ADDR A:0x1e29004
y.create.l HWIO_APPS_SMMU_CB10_ACTLR_APPS_ADDR A:0x1e2a004
y.create.l HWIO_APPS_SMMU_CB11_ACTLR_APPS_ADDR A:0x1e2b004
y.create.l HWIO_APPS_SMMU_CB12_ACTLR_APPS_ADDR A:0x1e2c004
y.create.l HWIO_APPS_SMMU_CB13_ACTLR_APPS_ADDR A:0x1e2d004
y.create.l HWIO_APPS_SMMU_CB14_ACTLR_APPS_ADDR A:0x1e2e004
y.create.l HWIO_APPS_SMMU_CB15_ACTLR_APPS_ADDR A:0x1e2f004
y.create.l HWIO_APPS_SMMU_CB16_ACTLR_APPS_ADDR A:0x1e30004
y.create.l HWIO_APPS_SMMU_CB17_ACTLR_APPS_ADDR A:0x1e31004
y.create.l HWIO_APPS_SMMU_CB18_ACTLR_APPS_ADDR A:0x1e32004
y.create.l HWIO_APPS_SMMU_CB19_ACTLR_APPS_ADDR A:0x1e33004
y.create.l HWIO_APPS_SMMU_CB20_ACTLR_APPS_ADDR A:0x1e34004
y.create.l HWIO_APPS_SMMU_CB21_ACTLR_APPS_ADDR A:0x1e35004
y.create.l HWIO_APPS_SMMU_CB22_ACTLR_APPS_ADDR A:0x1e36004
y.create.l HWIO_APPS_SMMU_CB23_ACTLR_APPS_ADDR A:0x1e37004
y.create.l HWIO_APPS_SMMU_CB24_ACTLR_APPS_ADDR A:0x1e38004
y.create.l HWIO_APPS_SMMU_CB25_ACTLR_APPS_ADDR A:0x1e39004
y.create.l HWIO_APPS_SMMU_CB26_ACTLR_APPS_ADDR A:0x1e3a004
y.create.l HWIO_APPS_SMMU_CB27_ACTLR_APPS_ADDR A:0x1e3b004
y.create.l HWIO_APPS_SMMU_CB28_ACTLR_APPS_ADDR A:0x1e3c004
y.create.l HWIO_APPS_SMMU_CB29_ACTLR_APPS_ADDR A:0x1e3d004
y.create.l HWIO_APPS_SMMU_CB30_ACTLR_APPS_ADDR A:0x1e3e004
y.create.l HWIO_APPS_SMMU_CB31_ACTLR_APPS_ADDR A:0x1e3f004
y.create.l HWIO_APPS_SMMU_CB0_RESUME_APPS_ADDR A:0x1e20008
y.create.l HWIO_APPS_SMMU_CB1_RESUME_APPS_ADDR A:0x1e21008
y.create.l HWIO_APPS_SMMU_CB2_RESUME_APPS_ADDR A:0x1e22008
y.create.l HWIO_APPS_SMMU_CB3_RESUME_APPS_ADDR A:0x1e23008
y.create.l HWIO_APPS_SMMU_CB4_RESUME_APPS_ADDR A:0x1e24008
y.create.l HWIO_APPS_SMMU_CB5_RESUME_APPS_ADDR A:0x1e25008
y.create.l HWIO_APPS_SMMU_CB6_RESUME_APPS_ADDR A:0x1e26008
y.create.l HWIO_APPS_SMMU_CB7_RESUME_APPS_ADDR A:0x1e27008
y.create.l HWIO_APPS_SMMU_CB8_RESUME_APPS_ADDR A:0x1e28008
y.create.l HWIO_APPS_SMMU_CB9_RESUME_APPS_ADDR A:0x1e29008
y.create.l HWIO_APPS_SMMU_CB10_RESUME_APPS_ADDR A:0x1e2a008
y.create.l HWIO_APPS_SMMU_CB11_RESUME_APPS_ADDR A:0x1e2b008
y.create.l HWIO_APPS_SMMU_CB12_RESUME_APPS_ADDR A:0x1e2c008
y.create.l HWIO_APPS_SMMU_CB13_RESUME_APPS_ADDR A:0x1e2d008
y.create.l HWIO_APPS_SMMU_CB14_RESUME_APPS_ADDR A:0x1e2e008
y.create.l HWIO_APPS_SMMU_CB15_RESUME_APPS_ADDR A:0x1e2f008
y.create.l HWIO_APPS_SMMU_CB16_RESUME_APPS_ADDR A:0x1e30008
y.create.l HWIO_APPS_SMMU_CB17_RESUME_APPS_ADDR A:0x1e31008
y.create.l HWIO_APPS_SMMU_CB18_RESUME_APPS_ADDR A:0x1e32008
y.create.l HWIO_APPS_SMMU_CB19_RESUME_APPS_ADDR A:0x1e33008
y.create.l HWIO_APPS_SMMU_CB20_RESUME_APPS_ADDR A:0x1e34008
y.create.l HWIO_APPS_SMMU_CB21_RESUME_APPS_ADDR A:0x1e35008
y.create.l HWIO_APPS_SMMU_CB22_RESUME_APPS_ADDR A:0x1e36008
y.create.l HWIO_APPS_SMMU_CB23_RESUME_APPS_ADDR A:0x1e37008
y.create.l HWIO_APPS_SMMU_CB24_RESUME_APPS_ADDR A:0x1e38008
y.create.l HWIO_APPS_SMMU_CB25_RESUME_APPS_ADDR A:0x1e39008
y.create.l HWIO_APPS_SMMU_CB26_RESUME_APPS_ADDR A:0x1e3a008
y.create.l HWIO_APPS_SMMU_CB27_RESUME_APPS_ADDR A:0x1e3b008
y.create.l HWIO_APPS_SMMU_CB28_RESUME_APPS_ADDR A:0x1e3c008
y.create.l HWIO_APPS_SMMU_CB29_RESUME_APPS_ADDR A:0x1e3d008
y.create.l HWIO_APPS_SMMU_CB30_RESUME_APPS_ADDR A:0x1e3e008
y.create.l HWIO_APPS_SMMU_CB31_RESUME_APPS_ADDR A:0x1e3f008
y.create.l HWIO_APPS_SMMU_CB0_TCR2_APPS_ADDR A:0x1e20010
y.create.l HWIO_APPS_SMMU_CB1_TCR2_APPS_ADDR A:0x1e21010
y.create.l HWIO_APPS_SMMU_CB2_TCR2_APPS_ADDR A:0x1e22010
y.create.l HWIO_APPS_SMMU_CB3_TCR2_APPS_ADDR A:0x1e23010
y.create.l HWIO_APPS_SMMU_CB4_TCR2_APPS_ADDR A:0x1e24010
y.create.l HWIO_APPS_SMMU_CB5_TCR2_APPS_ADDR A:0x1e25010
y.create.l HWIO_APPS_SMMU_CB6_TCR2_APPS_ADDR A:0x1e26010
y.create.l HWIO_APPS_SMMU_CB7_TCR2_APPS_ADDR A:0x1e27010
y.create.l HWIO_APPS_SMMU_CB8_TCR2_APPS_ADDR A:0x1e28010
y.create.l HWIO_APPS_SMMU_CB9_TCR2_APPS_ADDR A:0x1e29010
y.create.l HWIO_APPS_SMMU_CB10_TCR2_APPS_ADDR A:0x1e2a010
y.create.l HWIO_APPS_SMMU_CB11_TCR2_APPS_ADDR A:0x1e2b010
y.create.l HWIO_APPS_SMMU_CB12_TCR2_APPS_ADDR A:0x1e2c010
y.create.l HWIO_APPS_SMMU_CB13_TCR2_APPS_ADDR A:0x1e2d010
y.create.l HWIO_APPS_SMMU_CB14_TCR2_APPS_ADDR A:0x1e2e010
y.create.l HWIO_APPS_SMMU_CB15_TCR2_APPS_ADDR A:0x1e2f010
y.create.l HWIO_APPS_SMMU_CB16_TCR2_APPS_ADDR A:0x1e30010
y.create.l HWIO_APPS_SMMU_CB17_TCR2_APPS_ADDR A:0x1e31010
y.create.l HWIO_APPS_SMMU_CB18_TCR2_APPS_ADDR A:0x1e32010
y.create.l HWIO_APPS_SMMU_CB19_TCR2_APPS_ADDR A:0x1e33010
y.create.l HWIO_APPS_SMMU_CB20_TCR2_APPS_ADDR A:0x1e34010
y.create.l HWIO_APPS_SMMU_CB21_TCR2_APPS_ADDR A:0x1e35010
y.create.l HWIO_APPS_SMMU_CB22_TCR2_APPS_ADDR A:0x1e36010
y.create.l HWIO_APPS_SMMU_CB23_TCR2_APPS_ADDR A:0x1e37010
y.create.l HWIO_APPS_SMMU_CB24_TCR2_APPS_ADDR A:0x1e38010
y.create.l HWIO_APPS_SMMU_CB25_TCR2_APPS_ADDR A:0x1e39010
y.create.l HWIO_APPS_SMMU_CB26_TCR2_APPS_ADDR A:0x1e3a010
y.create.l HWIO_APPS_SMMU_CB27_TCR2_APPS_ADDR A:0x1e3b010
y.create.l HWIO_APPS_SMMU_CB28_TCR2_APPS_ADDR A:0x1e3c010
y.create.l HWIO_APPS_SMMU_CB29_TCR2_APPS_ADDR A:0x1e3d010
y.create.l HWIO_APPS_SMMU_CB30_TCR2_APPS_ADDR A:0x1e3e010
y.create.l HWIO_APPS_SMMU_CB31_TCR2_APPS_ADDR A:0x1e3f010
y.create.l HWIO_APPS_SMMU_CB0_TTBR0_LOW_APPS_ADDR A:0x1e20020
y.create.l HWIO_APPS_SMMU_CB1_TTBR0_LOW_APPS_ADDR A:0x1e21020
y.create.l HWIO_APPS_SMMU_CB2_TTBR0_LOW_APPS_ADDR A:0x1e22020
y.create.l HWIO_APPS_SMMU_CB3_TTBR0_LOW_APPS_ADDR A:0x1e23020
y.create.l HWIO_APPS_SMMU_CB4_TTBR0_LOW_APPS_ADDR A:0x1e24020
y.create.l HWIO_APPS_SMMU_CB5_TTBR0_LOW_APPS_ADDR A:0x1e25020
y.create.l HWIO_APPS_SMMU_CB6_TTBR0_LOW_APPS_ADDR A:0x1e26020
y.create.l HWIO_APPS_SMMU_CB7_TTBR0_LOW_APPS_ADDR A:0x1e27020
y.create.l HWIO_APPS_SMMU_CB8_TTBR0_LOW_APPS_ADDR A:0x1e28020
y.create.l HWIO_APPS_SMMU_CB9_TTBR0_LOW_APPS_ADDR A:0x1e29020
y.create.l HWIO_APPS_SMMU_CB10_TTBR0_LOW_APPS_ADDR A:0x1e2a020
y.create.l HWIO_APPS_SMMU_CB11_TTBR0_LOW_APPS_ADDR A:0x1e2b020
y.create.l HWIO_APPS_SMMU_CB12_TTBR0_LOW_APPS_ADDR A:0x1e2c020
y.create.l HWIO_APPS_SMMU_CB13_TTBR0_LOW_APPS_ADDR A:0x1e2d020
y.create.l HWIO_APPS_SMMU_CB14_TTBR0_LOW_APPS_ADDR A:0x1e2e020
y.create.l HWIO_APPS_SMMU_CB15_TTBR0_LOW_APPS_ADDR A:0x1e2f020
y.create.l HWIO_APPS_SMMU_CB16_TTBR0_LOW_APPS_ADDR A:0x1e30020
y.create.l HWIO_APPS_SMMU_CB17_TTBR0_LOW_APPS_ADDR A:0x1e31020
y.create.l HWIO_APPS_SMMU_CB18_TTBR0_LOW_APPS_ADDR A:0x1e32020
y.create.l HWIO_APPS_SMMU_CB19_TTBR0_LOW_APPS_ADDR A:0x1e33020
y.create.l HWIO_APPS_SMMU_CB20_TTBR0_LOW_APPS_ADDR A:0x1e34020
y.create.l HWIO_APPS_SMMU_CB21_TTBR0_LOW_APPS_ADDR A:0x1e35020
y.create.l HWIO_APPS_SMMU_CB22_TTBR0_LOW_APPS_ADDR A:0x1e36020
y.create.l HWIO_APPS_SMMU_CB23_TTBR0_LOW_APPS_ADDR A:0x1e37020
y.create.l HWIO_APPS_SMMU_CB24_TTBR0_LOW_APPS_ADDR A:0x1e38020
y.create.l HWIO_APPS_SMMU_CB25_TTBR0_LOW_APPS_ADDR A:0x1e39020
y.create.l HWIO_APPS_SMMU_CB26_TTBR0_LOW_APPS_ADDR A:0x1e3a020
y.create.l HWIO_APPS_SMMU_CB27_TTBR0_LOW_APPS_ADDR A:0x1e3b020
y.create.l HWIO_APPS_SMMU_CB28_TTBR0_LOW_APPS_ADDR A:0x1e3c020
y.create.l HWIO_APPS_SMMU_CB29_TTBR0_LOW_APPS_ADDR A:0x1e3d020
y.create.l HWIO_APPS_SMMU_CB30_TTBR0_LOW_APPS_ADDR A:0x1e3e020
y.create.l HWIO_APPS_SMMU_CB31_TTBR0_LOW_APPS_ADDR A:0x1e3f020
y.create.l HWIO_APPS_SMMU_CB0_TTBR0_HIGH_APPS_ADDR A:0x1e20024
y.create.l HWIO_APPS_SMMU_CB1_TTBR0_HIGH_APPS_ADDR A:0x1e21024
y.create.l HWIO_APPS_SMMU_CB2_TTBR0_HIGH_APPS_ADDR A:0x1e22024
y.create.l HWIO_APPS_SMMU_CB3_TTBR0_HIGH_APPS_ADDR A:0x1e23024
y.create.l HWIO_APPS_SMMU_CB4_TTBR0_HIGH_APPS_ADDR A:0x1e24024
y.create.l HWIO_APPS_SMMU_CB5_TTBR0_HIGH_APPS_ADDR A:0x1e25024
y.create.l HWIO_APPS_SMMU_CB6_TTBR0_HIGH_APPS_ADDR A:0x1e26024
y.create.l HWIO_APPS_SMMU_CB7_TTBR0_HIGH_APPS_ADDR A:0x1e27024
y.create.l HWIO_APPS_SMMU_CB8_TTBR0_HIGH_APPS_ADDR A:0x1e28024
y.create.l HWIO_APPS_SMMU_CB9_TTBR0_HIGH_APPS_ADDR A:0x1e29024
y.create.l HWIO_APPS_SMMU_CB10_TTBR0_HIGH_APPS_ADDR A:0x1e2a024
y.create.l HWIO_APPS_SMMU_CB11_TTBR0_HIGH_APPS_ADDR A:0x1e2b024
y.create.l HWIO_APPS_SMMU_CB12_TTBR0_HIGH_APPS_ADDR A:0x1e2c024
y.create.l HWIO_APPS_SMMU_CB13_TTBR0_HIGH_APPS_ADDR A:0x1e2d024
y.create.l HWIO_APPS_SMMU_CB14_TTBR0_HIGH_APPS_ADDR A:0x1e2e024
y.create.l HWIO_APPS_SMMU_CB15_TTBR0_HIGH_APPS_ADDR A:0x1e2f024
y.create.l HWIO_APPS_SMMU_CB16_TTBR0_HIGH_APPS_ADDR A:0x1e30024
y.create.l HWIO_APPS_SMMU_CB17_TTBR0_HIGH_APPS_ADDR A:0x1e31024
y.create.l HWIO_APPS_SMMU_CB18_TTBR0_HIGH_APPS_ADDR A:0x1e32024
y.create.l HWIO_APPS_SMMU_CB19_TTBR0_HIGH_APPS_ADDR A:0x1e33024
y.create.l HWIO_APPS_SMMU_CB20_TTBR0_HIGH_APPS_ADDR A:0x1e34024
y.create.l HWIO_APPS_SMMU_CB21_TTBR0_HIGH_APPS_ADDR A:0x1e35024
y.create.l HWIO_APPS_SMMU_CB22_TTBR0_HIGH_APPS_ADDR A:0x1e36024
y.create.l HWIO_APPS_SMMU_CB23_TTBR0_HIGH_APPS_ADDR A:0x1e37024
y.create.l HWIO_APPS_SMMU_CB24_TTBR0_HIGH_APPS_ADDR A:0x1e38024
y.create.l HWIO_APPS_SMMU_CB25_TTBR0_HIGH_APPS_ADDR A:0x1e39024
y.create.l HWIO_APPS_SMMU_CB26_TTBR0_HIGH_APPS_ADDR A:0x1e3a024
y.create.l HWIO_APPS_SMMU_CB27_TTBR0_HIGH_APPS_ADDR A:0x1e3b024
y.create.l HWIO_APPS_SMMU_CB28_TTBR0_HIGH_APPS_ADDR A:0x1e3c024
y.create.l HWIO_APPS_SMMU_CB29_TTBR0_HIGH_APPS_ADDR A:0x1e3d024
y.create.l HWIO_APPS_SMMU_CB30_TTBR0_HIGH_APPS_ADDR A:0x1e3e024
y.create.l HWIO_APPS_SMMU_CB31_TTBR0_HIGH_APPS_ADDR A:0x1e3f024
y.create.l HWIO_APPS_SMMU_CB0_TTBR1_LOW_APPS_ADDR A:0x1e20028
y.create.l HWIO_APPS_SMMU_CB1_TTBR1_LOW_APPS_ADDR A:0x1e21028
y.create.l HWIO_APPS_SMMU_CB2_TTBR1_LOW_APPS_ADDR A:0x1e22028
y.create.l HWIO_APPS_SMMU_CB3_TTBR1_LOW_APPS_ADDR A:0x1e23028
y.create.l HWIO_APPS_SMMU_CB4_TTBR1_LOW_APPS_ADDR A:0x1e24028
y.create.l HWIO_APPS_SMMU_CB5_TTBR1_LOW_APPS_ADDR A:0x1e25028
y.create.l HWIO_APPS_SMMU_CB6_TTBR1_LOW_APPS_ADDR A:0x1e26028
y.create.l HWIO_APPS_SMMU_CB7_TTBR1_LOW_APPS_ADDR A:0x1e27028
y.create.l HWIO_APPS_SMMU_CB8_TTBR1_LOW_APPS_ADDR A:0x1e28028
y.create.l HWIO_APPS_SMMU_CB9_TTBR1_LOW_APPS_ADDR A:0x1e29028
y.create.l HWIO_APPS_SMMU_CB10_TTBR1_LOW_APPS_ADDR A:0x1e2a028
y.create.l HWIO_APPS_SMMU_CB11_TTBR1_LOW_APPS_ADDR A:0x1e2b028
y.create.l HWIO_APPS_SMMU_CB12_TTBR1_LOW_APPS_ADDR A:0x1e2c028
y.create.l HWIO_APPS_SMMU_CB13_TTBR1_LOW_APPS_ADDR A:0x1e2d028
y.create.l HWIO_APPS_SMMU_CB14_TTBR1_LOW_APPS_ADDR A:0x1e2e028
y.create.l HWIO_APPS_SMMU_CB15_TTBR1_LOW_APPS_ADDR A:0x1e2f028
y.create.l HWIO_APPS_SMMU_CB16_TTBR1_LOW_APPS_ADDR A:0x1e30028
y.create.l HWIO_APPS_SMMU_CB17_TTBR1_LOW_APPS_ADDR A:0x1e31028
y.create.l HWIO_APPS_SMMU_CB18_TTBR1_LOW_APPS_ADDR A:0x1e32028
y.create.l HWIO_APPS_SMMU_CB19_TTBR1_LOW_APPS_ADDR A:0x1e33028
y.create.l HWIO_APPS_SMMU_CB20_TTBR1_LOW_APPS_ADDR A:0x1e34028
y.create.l HWIO_APPS_SMMU_CB21_TTBR1_LOW_APPS_ADDR A:0x1e35028
y.create.l HWIO_APPS_SMMU_CB22_TTBR1_LOW_APPS_ADDR A:0x1e36028
y.create.l HWIO_APPS_SMMU_CB23_TTBR1_LOW_APPS_ADDR A:0x1e37028
y.create.l HWIO_APPS_SMMU_CB24_TTBR1_LOW_APPS_ADDR A:0x1e38028
y.create.l HWIO_APPS_SMMU_CB25_TTBR1_LOW_APPS_ADDR A:0x1e39028
y.create.l HWIO_APPS_SMMU_CB26_TTBR1_LOW_APPS_ADDR A:0x1e3a028
y.create.l HWIO_APPS_SMMU_CB27_TTBR1_LOW_APPS_ADDR A:0x1e3b028
y.create.l HWIO_APPS_SMMU_CB28_TTBR1_LOW_APPS_ADDR A:0x1e3c028
y.create.l HWIO_APPS_SMMU_CB29_TTBR1_LOW_APPS_ADDR A:0x1e3d028
y.create.l HWIO_APPS_SMMU_CB30_TTBR1_LOW_APPS_ADDR A:0x1e3e028
y.create.l HWIO_APPS_SMMU_CB31_TTBR1_LOW_APPS_ADDR A:0x1e3f028
y.create.l HWIO_APPS_SMMU_CB0_TTBR1_HIGH_APPS_ADDR A:0x1e2002c
y.create.l HWIO_APPS_SMMU_CB1_TTBR1_HIGH_APPS_ADDR A:0x1e2102c
y.create.l HWIO_APPS_SMMU_CB2_TTBR1_HIGH_APPS_ADDR A:0x1e2202c
y.create.l HWIO_APPS_SMMU_CB3_TTBR1_HIGH_APPS_ADDR A:0x1e2302c
y.create.l HWIO_APPS_SMMU_CB4_TTBR1_HIGH_APPS_ADDR A:0x1e2402c
y.create.l HWIO_APPS_SMMU_CB5_TTBR1_HIGH_APPS_ADDR A:0x1e2502c
y.create.l HWIO_APPS_SMMU_CB6_TTBR1_HIGH_APPS_ADDR A:0x1e2602c
y.create.l HWIO_APPS_SMMU_CB7_TTBR1_HIGH_APPS_ADDR A:0x1e2702c
y.create.l HWIO_APPS_SMMU_CB8_TTBR1_HIGH_APPS_ADDR A:0x1e2802c
y.create.l HWIO_APPS_SMMU_CB9_TTBR1_HIGH_APPS_ADDR A:0x1e2902c
y.create.l HWIO_APPS_SMMU_CB10_TTBR1_HIGH_APPS_ADDR A:0x1e2a02c
y.create.l HWIO_APPS_SMMU_CB11_TTBR1_HIGH_APPS_ADDR A:0x1e2b02c
y.create.l HWIO_APPS_SMMU_CB12_TTBR1_HIGH_APPS_ADDR A:0x1e2c02c
y.create.l HWIO_APPS_SMMU_CB13_TTBR1_HIGH_APPS_ADDR A:0x1e2d02c
y.create.l HWIO_APPS_SMMU_CB14_TTBR1_HIGH_APPS_ADDR A:0x1e2e02c
y.create.l HWIO_APPS_SMMU_CB15_TTBR1_HIGH_APPS_ADDR A:0x1e2f02c
y.create.l HWIO_APPS_SMMU_CB16_TTBR1_HIGH_APPS_ADDR A:0x1e3002c
y.create.l HWIO_APPS_SMMU_CB17_TTBR1_HIGH_APPS_ADDR A:0x1e3102c
y.create.l HWIO_APPS_SMMU_CB18_TTBR1_HIGH_APPS_ADDR A:0x1e3202c
y.create.l HWIO_APPS_SMMU_CB19_TTBR1_HIGH_APPS_ADDR A:0x1e3302c
y.create.l HWIO_APPS_SMMU_CB20_TTBR1_HIGH_APPS_ADDR A:0x1e3402c
y.create.l HWIO_APPS_SMMU_CB21_TTBR1_HIGH_APPS_ADDR A:0x1e3502c
y.create.l HWIO_APPS_SMMU_CB22_TTBR1_HIGH_APPS_ADDR A:0x1e3602c
y.create.l HWIO_APPS_SMMU_CB23_TTBR1_HIGH_APPS_ADDR A:0x1e3702c
y.create.l HWIO_APPS_SMMU_CB24_TTBR1_HIGH_APPS_ADDR A:0x1e3802c
y.create.l HWIO_APPS_SMMU_CB25_TTBR1_HIGH_APPS_ADDR A:0x1e3902c
y.create.l HWIO_APPS_SMMU_CB26_TTBR1_HIGH_APPS_ADDR A:0x1e3a02c
y.create.l HWIO_APPS_SMMU_CB27_TTBR1_HIGH_APPS_ADDR A:0x1e3b02c
y.create.l HWIO_APPS_SMMU_CB28_TTBR1_HIGH_APPS_ADDR A:0x1e3c02c
y.create.l HWIO_APPS_SMMU_CB29_TTBR1_HIGH_APPS_ADDR A:0x1e3d02c
y.create.l HWIO_APPS_SMMU_CB30_TTBR1_HIGH_APPS_ADDR A:0x1e3e02c
y.create.l HWIO_APPS_SMMU_CB31_TTBR1_HIGH_APPS_ADDR A:0x1e3f02c
y.create.l HWIO_APPS_SMMU_CB0_TCR_LPAE_APPS_ADDR A:0x1e20030
y.create.l HWIO_APPS_SMMU_CB1_TCR_LPAE_APPS_ADDR A:0x1e21030
y.create.l HWIO_APPS_SMMU_CB2_TCR_LPAE_APPS_ADDR A:0x1e22030
y.create.l HWIO_APPS_SMMU_CB3_TCR_LPAE_APPS_ADDR A:0x1e23030
y.create.l HWIO_APPS_SMMU_CB4_TCR_LPAE_APPS_ADDR A:0x1e24030
y.create.l HWIO_APPS_SMMU_CB5_TCR_LPAE_APPS_ADDR A:0x1e25030
y.create.l HWIO_APPS_SMMU_CB6_TCR_LPAE_APPS_ADDR A:0x1e26030
y.create.l HWIO_APPS_SMMU_CB7_TCR_LPAE_APPS_ADDR A:0x1e27030
y.create.l HWIO_APPS_SMMU_CB8_TCR_LPAE_APPS_ADDR A:0x1e28030
y.create.l HWIO_APPS_SMMU_CB9_TCR_LPAE_APPS_ADDR A:0x1e29030
y.create.l HWIO_APPS_SMMU_CB10_TCR_LPAE_APPS_ADDR A:0x1e2a030
y.create.l HWIO_APPS_SMMU_CB11_TCR_LPAE_APPS_ADDR A:0x1e2b030
y.create.l HWIO_APPS_SMMU_CB12_TCR_LPAE_APPS_ADDR A:0x1e2c030
y.create.l HWIO_APPS_SMMU_CB13_TCR_LPAE_APPS_ADDR A:0x1e2d030
y.create.l HWIO_APPS_SMMU_CB14_TCR_LPAE_APPS_ADDR A:0x1e2e030
y.create.l HWIO_APPS_SMMU_CB15_TCR_LPAE_APPS_ADDR A:0x1e2f030
y.create.l HWIO_APPS_SMMU_CB16_TCR_LPAE_APPS_ADDR A:0x1e30030
y.create.l HWIO_APPS_SMMU_CB17_TCR_LPAE_APPS_ADDR A:0x1e31030
y.create.l HWIO_APPS_SMMU_CB18_TCR_LPAE_APPS_ADDR A:0x1e32030
y.create.l HWIO_APPS_SMMU_CB19_TCR_LPAE_APPS_ADDR A:0x1e33030
y.create.l HWIO_APPS_SMMU_CB20_TCR_LPAE_APPS_ADDR A:0x1e34030
y.create.l HWIO_APPS_SMMU_CB21_TCR_LPAE_APPS_ADDR A:0x1e35030
y.create.l HWIO_APPS_SMMU_CB22_TCR_LPAE_APPS_ADDR A:0x1e36030
y.create.l HWIO_APPS_SMMU_CB23_TCR_LPAE_APPS_ADDR A:0x1e37030
y.create.l HWIO_APPS_SMMU_CB24_TCR_LPAE_APPS_ADDR A:0x1e38030
y.create.l HWIO_APPS_SMMU_CB25_TCR_LPAE_APPS_ADDR A:0x1e39030
y.create.l HWIO_APPS_SMMU_CB26_TCR_LPAE_APPS_ADDR A:0x1e3a030
y.create.l HWIO_APPS_SMMU_CB27_TCR_LPAE_APPS_ADDR A:0x1e3b030
y.create.l HWIO_APPS_SMMU_CB28_TCR_LPAE_APPS_ADDR A:0x1e3c030
y.create.l HWIO_APPS_SMMU_CB29_TCR_LPAE_APPS_ADDR A:0x1e3d030
y.create.l HWIO_APPS_SMMU_CB30_TCR_LPAE_APPS_ADDR A:0x1e3e030
y.create.l HWIO_APPS_SMMU_CB31_TCR_LPAE_APPS_ADDR A:0x1e3f030
y.create.l HWIO_APPS_SMMU_CB0_CONTEXTIDR_APPS_ADDR A:0x1e20034
y.create.l HWIO_APPS_SMMU_CB1_CONTEXTIDR_APPS_ADDR A:0x1e21034
y.create.l HWIO_APPS_SMMU_CB2_CONTEXTIDR_APPS_ADDR A:0x1e22034
y.create.l HWIO_APPS_SMMU_CB3_CONTEXTIDR_APPS_ADDR A:0x1e23034
y.create.l HWIO_APPS_SMMU_CB4_CONTEXTIDR_APPS_ADDR A:0x1e24034
y.create.l HWIO_APPS_SMMU_CB5_CONTEXTIDR_APPS_ADDR A:0x1e25034
y.create.l HWIO_APPS_SMMU_CB6_CONTEXTIDR_APPS_ADDR A:0x1e26034
y.create.l HWIO_APPS_SMMU_CB7_CONTEXTIDR_APPS_ADDR A:0x1e27034
y.create.l HWIO_APPS_SMMU_CB8_CONTEXTIDR_APPS_ADDR A:0x1e28034
y.create.l HWIO_APPS_SMMU_CB9_CONTEXTIDR_APPS_ADDR A:0x1e29034
y.create.l HWIO_APPS_SMMU_CB10_CONTEXTIDR_APPS_ADDR A:0x1e2a034
y.create.l HWIO_APPS_SMMU_CB11_CONTEXTIDR_APPS_ADDR A:0x1e2b034
y.create.l HWIO_APPS_SMMU_CB12_CONTEXTIDR_APPS_ADDR A:0x1e2c034
y.create.l HWIO_APPS_SMMU_CB13_CONTEXTIDR_APPS_ADDR A:0x1e2d034
y.create.l HWIO_APPS_SMMU_CB14_CONTEXTIDR_APPS_ADDR A:0x1e2e034
y.create.l HWIO_APPS_SMMU_CB15_CONTEXTIDR_APPS_ADDR A:0x1e2f034
y.create.l HWIO_APPS_SMMU_CB16_CONTEXTIDR_APPS_ADDR A:0x1e30034
y.create.l HWIO_APPS_SMMU_CB17_CONTEXTIDR_APPS_ADDR A:0x1e31034
y.create.l HWIO_APPS_SMMU_CB18_CONTEXTIDR_APPS_ADDR A:0x1e32034
y.create.l HWIO_APPS_SMMU_CB19_CONTEXTIDR_APPS_ADDR A:0x1e33034
y.create.l HWIO_APPS_SMMU_CB20_CONTEXTIDR_APPS_ADDR A:0x1e34034
y.create.l HWIO_APPS_SMMU_CB21_CONTEXTIDR_APPS_ADDR A:0x1e35034
y.create.l HWIO_APPS_SMMU_CB22_CONTEXTIDR_APPS_ADDR A:0x1e36034
y.create.l HWIO_APPS_SMMU_CB23_CONTEXTIDR_APPS_ADDR A:0x1e37034
y.create.l HWIO_APPS_SMMU_CB24_CONTEXTIDR_APPS_ADDR A:0x1e38034
y.create.l HWIO_APPS_SMMU_CB25_CONTEXTIDR_APPS_ADDR A:0x1e39034
y.create.l HWIO_APPS_SMMU_CB26_CONTEXTIDR_APPS_ADDR A:0x1e3a034
y.create.l HWIO_APPS_SMMU_CB27_CONTEXTIDR_APPS_ADDR A:0x1e3b034
y.create.l HWIO_APPS_SMMU_CB28_CONTEXTIDR_APPS_ADDR A:0x1e3c034
y.create.l HWIO_APPS_SMMU_CB29_CONTEXTIDR_APPS_ADDR A:0x1e3d034
y.create.l HWIO_APPS_SMMU_CB30_CONTEXTIDR_APPS_ADDR A:0x1e3e034
y.create.l HWIO_APPS_SMMU_CB31_CONTEXTIDR_APPS_ADDR A:0x1e3f034
y.create.l HWIO_APPS_SMMU_CB0_PRRR_MAIR0_APPS_ADDR A:0x1e20038
y.create.l HWIO_APPS_SMMU_CB1_PRRR_MAIR0_APPS_ADDR A:0x1e21038
y.create.l HWIO_APPS_SMMU_CB2_PRRR_MAIR0_APPS_ADDR A:0x1e22038
y.create.l HWIO_APPS_SMMU_CB3_PRRR_MAIR0_APPS_ADDR A:0x1e23038
y.create.l HWIO_APPS_SMMU_CB4_PRRR_MAIR0_APPS_ADDR A:0x1e24038
y.create.l HWIO_APPS_SMMU_CB5_PRRR_MAIR0_APPS_ADDR A:0x1e25038
y.create.l HWIO_APPS_SMMU_CB6_PRRR_MAIR0_APPS_ADDR A:0x1e26038
y.create.l HWIO_APPS_SMMU_CB7_PRRR_MAIR0_APPS_ADDR A:0x1e27038
y.create.l HWIO_APPS_SMMU_CB8_PRRR_MAIR0_APPS_ADDR A:0x1e28038
y.create.l HWIO_APPS_SMMU_CB9_PRRR_MAIR0_APPS_ADDR A:0x1e29038
y.create.l HWIO_APPS_SMMU_CB10_PRRR_MAIR0_APPS_ADDR A:0x1e2a038
y.create.l HWIO_APPS_SMMU_CB11_PRRR_MAIR0_APPS_ADDR A:0x1e2b038
y.create.l HWIO_APPS_SMMU_CB12_PRRR_MAIR0_APPS_ADDR A:0x1e2c038
y.create.l HWIO_APPS_SMMU_CB13_PRRR_MAIR0_APPS_ADDR A:0x1e2d038
y.create.l HWIO_APPS_SMMU_CB14_PRRR_MAIR0_APPS_ADDR A:0x1e2e038
y.create.l HWIO_APPS_SMMU_CB15_PRRR_MAIR0_APPS_ADDR A:0x1e2f038
y.create.l HWIO_APPS_SMMU_CB16_PRRR_MAIR0_APPS_ADDR A:0x1e30038
y.create.l HWIO_APPS_SMMU_CB17_PRRR_MAIR0_APPS_ADDR A:0x1e31038
y.create.l HWIO_APPS_SMMU_CB18_PRRR_MAIR0_APPS_ADDR A:0x1e32038
y.create.l HWIO_APPS_SMMU_CB19_PRRR_MAIR0_APPS_ADDR A:0x1e33038
y.create.l HWIO_APPS_SMMU_CB20_PRRR_MAIR0_APPS_ADDR A:0x1e34038
y.create.l HWIO_APPS_SMMU_CB21_PRRR_MAIR0_APPS_ADDR A:0x1e35038
y.create.l HWIO_APPS_SMMU_CB22_PRRR_MAIR0_APPS_ADDR A:0x1e36038
y.create.l HWIO_APPS_SMMU_CB23_PRRR_MAIR0_APPS_ADDR A:0x1e37038
y.create.l HWIO_APPS_SMMU_CB24_PRRR_MAIR0_APPS_ADDR A:0x1e38038
y.create.l HWIO_APPS_SMMU_CB25_PRRR_MAIR0_APPS_ADDR A:0x1e39038
y.create.l HWIO_APPS_SMMU_CB26_PRRR_MAIR0_APPS_ADDR A:0x1e3a038
y.create.l HWIO_APPS_SMMU_CB27_PRRR_MAIR0_APPS_ADDR A:0x1e3b038
y.create.l HWIO_APPS_SMMU_CB28_PRRR_MAIR0_APPS_ADDR A:0x1e3c038
y.create.l HWIO_APPS_SMMU_CB29_PRRR_MAIR0_APPS_ADDR A:0x1e3d038
y.create.l HWIO_APPS_SMMU_CB30_PRRR_MAIR0_APPS_ADDR A:0x1e3e038
y.create.l HWIO_APPS_SMMU_CB31_PRRR_MAIR0_APPS_ADDR A:0x1e3f038
y.create.l HWIO_APPS_SMMU_CB0_NMRR_MAIR1_APPS_ADDR A:0x1e2003c
y.create.l HWIO_APPS_SMMU_CB1_NMRR_MAIR1_APPS_ADDR A:0x1e2103c
y.create.l HWIO_APPS_SMMU_CB2_NMRR_MAIR1_APPS_ADDR A:0x1e2203c
y.create.l HWIO_APPS_SMMU_CB3_NMRR_MAIR1_APPS_ADDR A:0x1e2303c
y.create.l HWIO_APPS_SMMU_CB4_NMRR_MAIR1_APPS_ADDR A:0x1e2403c
y.create.l HWIO_APPS_SMMU_CB5_NMRR_MAIR1_APPS_ADDR A:0x1e2503c
y.create.l HWIO_APPS_SMMU_CB6_NMRR_MAIR1_APPS_ADDR A:0x1e2603c
y.create.l HWIO_APPS_SMMU_CB7_NMRR_MAIR1_APPS_ADDR A:0x1e2703c
y.create.l HWIO_APPS_SMMU_CB8_NMRR_MAIR1_APPS_ADDR A:0x1e2803c
y.create.l HWIO_APPS_SMMU_CB9_NMRR_MAIR1_APPS_ADDR A:0x1e2903c
y.create.l HWIO_APPS_SMMU_CB10_NMRR_MAIR1_APPS_ADDR A:0x1e2a03c
y.create.l HWIO_APPS_SMMU_CB11_NMRR_MAIR1_APPS_ADDR A:0x1e2b03c
y.create.l HWIO_APPS_SMMU_CB12_NMRR_MAIR1_APPS_ADDR A:0x1e2c03c
y.create.l HWIO_APPS_SMMU_CB13_NMRR_MAIR1_APPS_ADDR A:0x1e2d03c
y.create.l HWIO_APPS_SMMU_CB14_NMRR_MAIR1_APPS_ADDR A:0x1e2e03c
y.create.l HWIO_APPS_SMMU_CB15_NMRR_MAIR1_APPS_ADDR A:0x1e2f03c
y.create.l HWIO_APPS_SMMU_CB16_NMRR_MAIR1_APPS_ADDR A:0x1e3003c
y.create.l HWIO_APPS_SMMU_CB17_NMRR_MAIR1_APPS_ADDR A:0x1e3103c
y.create.l HWIO_APPS_SMMU_CB18_NMRR_MAIR1_APPS_ADDR A:0x1e3203c
y.create.l HWIO_APPS_SMMU_CB19_NMRR_MAIR1_APPS_ADDR A:0x1e3303c
y.create.l HWIO_APPS_SMMU_CB20_NMRR_MAIR1_APPS_ADDR A:0x1e3403c
y.create.l HWIO_APPS_SMMU_CB21_NMRR_MAIR1_APPS_ADDR A:0x1e3503c
y.create.l HWIO_APPS_SMMU_CB22_NMRR_MAIR1_APPS_ADDR A:0x1e3603c
y.create.l HWIO_APPS_SMMU_CB23_NMRR_MAIR1_APPS_ADDR A:0x1e3703c
y.create.l HWIO_APPS_SMMU_CB24_NMRR_MAIR1_APPS_ADDR A:0x1e3803c
y.create.l HWIO_APPS_SMMU_CB25_NMRR_MAIR1_APPS_ADDR A:0x1e3903c
y.create.l HWIO_APPS_SMMU_CB26_NMRR_MAIR1_APPS_ADDR A:0x1e3a03c
y.create.l HWIO_APPS_SMMU_CB27_NMRR_MAIR1_APPS_ADDR A:0x1e3b03c
y.create.l HWIO_APPS_SMMU_CB28_NMRR_MAIR1_APPS_ADDR A:0x1e3c03c
y.create.l HWIO_APPS_SMMU_CB29_NMRR_MAIR1_APPS_ADDR A:0x1e3d03c
y.create.l HWIO_APPS_SMMU_CB30_NMRR_MAIR1_APPS_ADDR A:0x1e3e03c
y.create.l HWIO_APPS_SMMU_CB31_NMRR_MAIR1_APPS_ADDR A:0x1e3f03c
y.create.l HWIO_APPS_SMMU_CB0_FSR_APPS_ADDR A:0x1e20058
y.create.l HWIO_APPS_SMMU_CB1_FSR_APPS_ADDR A:0x1e21058
y.create.l HWIO_APPS_SMMU_CB2_FSR_APPS_ADDR A:0x1e22058
y.create.l HWIO_APPS_SMMU_CB3_FSR_APPS_ADDR A:0x1e23058
y.create.l HWIO_APPS_SMMU_CB4_FSR_APPS_ADDR A:0x1e24058
y.create.l HWIO_APPS_SMMU_CB5_FSR_APPS_ADDR A:0x1e25058
y.create.l HWIO_APPS_SMMU_CB6_FSR_APPS_ADDR A:0x1e26058
y.create.l HWIO_APPS_SMMU_CB7_FSR_APPS_ADDR A:0x1e27058
y.create.l HWIO_APPS_SMMU_CB8_FSR_APPS_ADDR A:0x1e28058
y.create.l HWIO_APPS_SMMU_CB9_FSR_APPS_ADDR A:0x1e29058
y.create.l HWIO_APPS_SMMU_CB10_FSR_APPS_ADDR A:0x1e2a058
y.create.l HWIO_APPS_SMMU_CB11_FSR_APPS_ADDR A:0x1e2b058
y.create.l HWIO_APPS_SMMU_CB12_FSR_APPS_ADDR A:0x1e2c058
y.create.l HWIO_APPS_SMMU_CB13_FSR_APPS_ADDR A:0x1e2d058
y.create.l HWIO_APPS_SMMU_CB14_FSR_APPS_ADDR A:0x1e2e058
y.create.l HWIO_APPS_SMMU_CB15_FSR_APPS_ADDR A:0x1e2f058
y.create.l HWIO_APPS_SMMU_CB16_FSR_APPS_ADDR A:0x1e30058
y.create.l HWIO_APPS_SMMU_CB17_FSR_APPS_ADDR A:0x1e31058
y.create.l HWIO_APPS_SMMU_CB18_FSR_APPS_ADDR A:0x1e32058
y.create.l HWIO_APPS_SMMU_CB19_FSR_APPS_ADDR A:0x1e33058
y.create.l HWIO_APPS_SMMU_CB20_FSR_APPS_ADDR A:0x1e34058
y.create.l HWIO_APPS_SMMU_CB21_FSR_APPS_ADDR A:0x1e35058
y.create.l HWIO_APPS_SMMU_CB22_FSR_APPS_ADDR A:0x1e36058
y.create.l HWIO_APPS_SMMU_CB23_FSR_APPS_ADDR A:0x1e37058
y.create.l HWIO_APPS_SMMU_CB24_FSR_APPS_ADDR A:0x1e38058
y.create.l HWIO_APPS_SMMU_CB25_FSR_APPS_ADDR A:0x1e39058
y.create.l HWIO_APPS_SMMU_CB26_FSR_APPS_ADDR A:0x1e3a058
y.create.l HWIO_APPS_SMMU_CB27_FSR_APPS_ADDR A:0x1e3b058
y.create.l HWIO_APPS_SMMU_CB28_FSR_APPS_ADDR A:0x1e3c058
y.create.l HWIO_APPS_SMMU_CB29_FSR_APPS_ADDR A:0x1e3d058
y.create.l HWIO_APPS_SMMU_CB30_FSR_APPS_ADDR A:0x1e3e058
y.create.l HWIO_APPS_SMMU_CB31_FSR_APPS_ADDR A:0x1e3f058
y.create.l HWIO_APPS_SMMU_CB0_FSRRESTORE_APPS_ADDR A:0x1e2005c
y.create.l HWIO_APPS_SMMU_CB1_FSRRESTORE_APPS_ADDR A:0x1e2105c
y.create.l HWIO_APPS_SMMU_CB2_FSRRESTORE_APPS_ADDR A:0x1e2205c
y.create.l HWIO_APPS_SMMU_CB3_FSRRESTORE_APPS_ADDR A:0x1e2305c
y.create.l HWIO_APPS_SMMU_CB4_FSRRESTORE_APPS_ADDR A:0x1e2405c
y.create.l HWIO_APPS_SMMU_CB5_FSRRESTORE_APPS_ADDR A:0x1e2505c
y.create.l HWIO_APPS_SMMU_CB6_FSRRESTORE_APPS_ADDR A:0x1e2605c
y.create.l HWIO_APPS_SMMU_CB7_FSRRESTORE_APPS_ADDR A:0x1e2705c
y.create.l HWIO_APPS_SMMU_CB8_FSRRESTORE_APPS_ADDR A:0x1e2805c
y.create.l HWIO_APPS_SMMU_CB9_FSRRESTORE_APPS_ADDR A:0x1e2905c
y.create.l HWIO_APPS_SMMU_CB10_FSRRESTORE_APPS_ADDR A:0x1e2a05c
y.create.l HWIO_APPS_SMMU_CB11_FSRRESTORE_APPS_ADDR A:0x1e2b05c
y.create.l HWIO_APPS_SMMU_CB12_FSRRESTORE_APPS_ADDR A:0x1e2c05c
y.create.l HWIO_APPS_SMMU_CB13_FSRRESTORE_APPS_ADDR A:0x1e2d05c
y.create.l HWIO_APPS_SMMU_CB14_FSRRESTORE_APPS_ADDR A:0x1e2e05c
y.create.l HWIO_APPS_SMMU_CB15_FSRRESTORE_APPS_ADDR A:0x1e2f05c
y.create.l HWIO_APPS_SMMU_CB16_FSRRESTORE_APPS_ADDR A:0x1e3005c
y.create.l HWIO_APPS_SMMU_CB17_FSRRESTORE_APPS_ADDR A:0x1e3105c
y.create.l HWIO_APPS_SMMU_CB18_FSRRESTORE_APPS_ADDR A:0x1e3205c
y.create.l HWIO_APPS_SMMU_CB19_FSRRESTORE_APPS_ADDR A:0x1e3305c
y.create.l HWIO_APPS_SMMU_CB20_FSRRESTORE_APPS_ADDR A:0x1e3405c
y.create.l HWIO_APPS_SMMU_CB21_FSRRESTORE_APPS_ADDR A:0x1e3505c
y.create.l HWIO_APPS_SMMU_CB22_FSRRESTORE_APPS_ADDR A:0x1e3605c
y.create.l HWIO_APPS_SMMU_CB23_FSRRESTORE_APPS_ADDR A:0x1e3705c
y.create.l HWIO_APPS_SMMU_CB24_FSRRESTORE_APPS_ADDR A:0x1e3805c
y.create.l HWIO_APPS_SMMU_CB25_FSRRESTORE_APPS_ADDR A:0x1e3905c
y.create.l HWIO_APPS_SMMU_CB26_FSRRESTORE_APPS_ADDR A:0x1e3a05c
y.create.l HWIO_APPS_SMMU_CB27_FSRRESTORE_APPS_ADDR A:0x1e3b05c
y.create.l HWIO_APPS_SMMU_CB28_FSRRESTORE_APPS_ADDR A:0x1e3c05c
y.create.l HWIO_APPS_SMMU_CB29_FSRRESTORE_APPS_ADDR A:0x1e3d05c
y.create.l HWIO_APPS_SMMU_CB30_FSRRESTORE_APPS_ADDR A:0x1e3e05c
y.create.l HWIO_APPS_SMMU_CB31_FSRRESTORE_APPS_ADDR A:0x1e3f05c
y.create.l HWIO_APPS_SMMU_CB0_FAR_LOW_APPS_ADDR A:0x1e20060
y.create.l HWIO_APPS_SMMU_CB1_FAR_LOW_APPS_ADDR A:0x1e21060
y.create.l HWIO_APPS_SMMU_CB2_FAR_LOW_APPS_ADDR A:0x1e22060
y.create.l HWIO_APPS_SMMU_CB3_FAR_LOW_APPS_ADDR A:0x1e23060
y.create.l HWIO_APPS_SMMU_CB4_FAR_LOW_APPS_ADDR A:0x1e24060
y.create.l HWIO_APPS_SMMU_CB5_FAR_LOW_APPS_ADDR A:0x1e25060
y.create.l HWIO_APPS_SMMU_CB6_FAR_LOW_APPS_ADDR A:0x1e26060
y.create.l HWIO_APPS_SMMU_CB7_FAR_LOW_APPS_ADDR A:0x1e27060
y.create.l HWIO_APPS_SMMU_CB8_FAR_LOW_APPS_ADDR A:0x1e28060
y.create.l HWIO_APPS_SMMU_CB9_FAR_LOW_APPS_ADDR A:0x1e29060
y.create.l HWIO_APPS_SMMU_CB10_FAR_LOW_APPS_ADDR A:0x1e2a060
y.create.l HWIO_APPS_SMMU_CB11_FAR_LOW_APPS_ADDR A:0x1e2b060
y.create.l HWIO_APPS_SMMU_CB12_FAR_LOW_APPS_ADDR A:0x1e2c060
y.create.l HWIO_APPS_SMMU_CB13_FAR_LOW_APPS_ADDR A:0x1e2d060
y.create.l HWIO_APPS_SMMU_CB14_FAR_LOW_APPS_ADDR A:0x1e2e060
y.create.l HWIO_APPS_SMMU_CB15_FAR_LOW_APPS_ADDR A:0x1e2f060
y.create.l HWIO_APPS_SMMU_CB16_FAR_LOW_APPS_ADDR A:0x1e30060
y.create.l HWIO_APPS_SMMU_CB17_FAR_LOW_APPS_ADDR A:0x1e31060
y.create.l HWIO_APPS_SMMU_CB18_FAR_LOW_APPS_ADDR A:0x1e32060
y.create.l HWIO_APPS_SMMU_CB19_FAR_LOW_APPS_ADDR A:0x1e33060
y.create.l HWIO_APPS_SMMU_CB20_FAR_LOW_APPS_ADDR A:0x1e34060
y.create.l HWIO_APPS_SMMU_CB21_FAR_LOW_APPS_ADDR A:0x1e35060
y.create.l HWIO_APPS_SMMU_CB22_FAR_LOW_APPS_ADDR A:0x1e36060
y.create.l HWIO_APPS_SMMU_CB23_FAR_LOW_APPS_ADDR A:0x1e37060
y.create.l HWIO_APPS_SMMU_CB24_FAR_LOW_APPS_ADDR A:0x1e38060
y.create.l HWIO_APPS_SMMU_CB25_FAR_LOW_APPS_ADDR A:0x1e39060
y.create.l HWIO_APPS_SMMU_CB26_FAR_LOW_APPS_ADDR A:0x1e3a060
y.create.l HWIO_APPS_SMMU_CB27_FAR_LOW_APPS_ADDR A:0x1e3b060
y.create.l HWIO_APPS_SMMU_CB28_FAR_LOW_APPS_ADDR A:0x1e3c060
y.create.l HWIO_APPS_SMMU_CB29_FAR_LOW_APPS_ADDR A:0x1e3d060
y.create.l HWIO_APPS_SMMU_CB30_FAR_LOW_APPS_ADDR A:0x1e3e060
y.create.l HWIO_APPS_SMMU_CB31_FAR_LOW_APPS_ADDR A:0x1e3f060
y.create.l HWIO_APPS_SMMU_CB0_FAR_HIGH_APPS_ADDR A:0x1e20064
y.create.l HWIO_APPS_SMMU_CB1_FAR_HIGH_APPS_ADDR A:0x1e21064
y.create.l HWIO_APPS_SMMU_CB2_FAR_HIGH_APPS_ADDR A:0x1e22064
y.create.l HWIO_APPS_SMMU_CB3_FAR_HIGH_APPS_ADDR A:0x1e23064
y.create.l HWIO_APPS_SMMU_CB4_FAR_HIGH_APPS_ADDR A:0x1e24064
y.create.l HWIO_APPS_SMMU_CB5_FAR_HIGH_APPS_ADDR A:0x1e25064
y.create.l HWIO_APPS_SMMU_CB6_FAR_HIGH_APPS_ADDR A:0x1e26064
y.create.l HWIO_APPS_SMMU_CB7_FAR_HIGH_APPS_ADDR A:0x1e27064
y.create.l HWIO_APPS_SMMU_CB8_FAR_HIGH_APPS_ADDR A:0x1e28064
y.create.l HWIO_APPS_SMMU_CB9_FAR_HIGH_APPS_ADDR A:0x1e29064
y.create.l HWIO_APPS_SMMU_CB10_FAR_HIGH_APPS_ADDR A:0x1e2a064
y.create.l HWIO_APPS_SMMU_CB11_FAR_HIGH_APPS_ADDR A:0x1e2b064
y.create.l HWIO_APPS_SMMU_CB12_FAR_HIGH_APPS_ADDR A:0x1e2c064
y.create.l HWIO_APPS_SMMU_CB13_FAR_HIGH_APPS_ADDR A:0x1e2d064
y.create.l HWIO_APPS_SMMU_CB14_FAR_HIGH_APPS_ADDR A:0x1e2e064
y.create.l HWIO_APPS_SMMU_CB15_FAR_HIGH_APPS_ADDR A:0x1e2f064
y.create.l HWIO_APPS_SMMU_CB16_FAR_HIGH_APPS_ADDR A:0x1e30064
y.create.l HWIO_APPS_SMMU_CB17_FAR_HIGH_APPS_ADDR A:0x1e31064
y.create.l HWIO_APPS_SMMU_CB18_FAR_HIGH_APPS_ADDR A:0x1e32064
y.create.l HWIO_APPS_SMMU_CB19_FAR_HIGH_APPS_ADDR A:0x1e33064
y.create.l HWIO_APPS_SMMU_CB20_FAR_HIGH_APPS_ADDR A:0x1e34064
y.create.l HWIO_APPS_SMMU_CB21_FAR_HIGH_APPS_ADDR A:0x1e35064
y.create.l HWIO_APPS_SMMU_CB22_FAR_HIGH_APPS_ADDR A:0x1e36064
y.create.l HWIO_APPS_SMMU_CB23_FAR_HIGH_APPS_ADDR A:0x1e37064
y.create.l HWIO_APPS_SMMU_CB24_FAR_HIGH_APPS_ADDR A:0x1e38064
y.create.l HWIO_APPS_SMMU_CB25_FAR_HIGH_APPS_ADDR A:0x1e39064
y.create.l HWIO_APPS_SMMU_CB26_FAR_HIGH_APPS_ADDR A:0x1e3a064
y.create.l HWIO_APPS_SMMU_CB27_FAR_HIGH_APPS_ADDR A:0x1e3b064
y.create.l HWIO_APPS_SMMU_CB28_FAR_HIGH_APPS_ADDR A:0x1e3c064
y.create.l HWIO_APPS_SMMU_CB29_FAR_HIGH_APPS_ADDR A:0x1e3d064
y.create.l HWIO_APPS_SMMU_CB30_FAR_HIGH_APPS_ADDR A:0x1e3e064
y.create.l HWIO_APPS_SMMU_CB31_FAR_HIGH_APPS_ADDR A:0x1e3f064
y.create.l HWIO_APPS_SMMU_CB0_FSYNR0_APPS_ADDR A:0x1e20068
y.create.l HWIO_APPS_SMMU_CB1_FSYNR0_APPS_ADDR A:0x1e21068
y.create.l HWIO_APPS_SMMU_CB2_FSYNR0_APPS_ADDR A:0x1e22068
y.create.l HWIO_APPS_SMMU_CB3_FSYNR0_APPS_ADDR A:0x1e23068
y.create.l HWIO_APPS_SMMU_CB4_FSYNR0_APPS_ADDR A:0x1e24068
y.create.l HWIO_APPS_SMMU_CB5_FSYNR0_APPS_ADDR A:0x1e25068
y.create.l HWIO_APPS_SMMU_CB6_FSYNR0_APPS_ADDR A:0x1e26068
y.create.l HWIO_APPS_SMMU_CB7_FSYNR0_APPS_ADDR A:0x1e27068
y.create.l HWIO_APPS_SMMU_CB8_FSYNR0_APPS_ADDR A:0x1e28068
y.create.l HWIO_APPS_SMMU_CB9_FSYNR0_APPS_ADDR A:0x1e29068
y.create.l HWIO_APPS_SMMU_CB10_FSYNR0_APPS_ADDR A:0x1e2a068
y.create.l HWIO_APPS_SMMU_CB11_FSYNR0_APPS_ADDR A:0x1e2b068
y.create.l HWIO_APPS_SMMU_CB12_FSYNR0_APPS_ADDR A:0x1e2c068
y.create.l HWIO_APPS_SMMU_CB13_FSYNR0_APPS_ADDR A:0x1e2d068
y.create.l HWIO_APPS_SMMU_CB14_FSYNR0_APPS_ADDR A:0x1e2e068
y.create.l HWIO_APPS_SMMU_CB15_FSYNR0_APPS_ADDR A:0x1e2f068
y.create.l HWIO_APPS_SMMU_CB16_FSYNR0_APPS_ADDR A:0x1e30068
y.create.l HWIO_APPS_SMMU_CB17_FSYNR0_APPS_ADDR A:0x1e31068
y.create.l HWIO_APPS_SMMU_CB18_FSYNR0_APPS_ADDR A:0x1e32068
y.create.l HWIO_APPS_SMMU_CB19_FSYNR0_APPS_ADDR A:0x1e33068
y.create.l HWIO_APPS_SMMU_CB20_FSYNR0_APPS_ADDR A:0x1e34068
y.create.l HWIO_APPS_SMMU_CB21_FSYNR0_APPS_ADDR A:0x1e35068
y.create.l HWIO_APPS_SMMU_CB22_FSYNR0_APPS_ADDR A:0x1e36068
y.create.l HWIO_APPS_SMMU_CB23_FSYNR0_APPS_ADDR A:0x1e37068
y.create.l HWIO_APPS_SMMU_CB24_FSYNR0_APPS_ADDR A:0x1e38068
y.create.l HWIO_APPS_SMMU_CB25_FSYNR0_APPS_ADDR A:0x1e39068
y.create.l HWIO_APPS_SMMU_CB26_FSYNR0_APPS_ADDR A:0x1e3a068
y.create.l HWIO_APPS_SMMU_CB27_FSYNR0_APPS_ADDR A:0x1e3b068
y.create.l HWIO_APPS_SMMU_CB28_FSYNR0_APPS_ADDR A:0x1e3c068
y.create.l HWIO_APPS_SMMU_CB29_FSYNR0_APPS_ADDR A:0x1e3d068
y.create.l HWIO_APPS_SMMU_CB30_FSYNR0_APPS_ADDR A:0x1e3e068
y.create.l HWIO_APPS_SMMU_CB31_FSYNR0_APPS_ADDR A:0x1e3f068
y.create.l HWIO_APPS_SMMU_CB0_IPAFAR_LOW_APPS_ADDR A:0x1e20070
y.create.l HWIO_APPS_SMMU_CB1_IPAFAR_LOW_APPS_ADDR A:0x1e21070
y.create.l HWIO_APPS_SMMU_CB2_IPAFAR_LOW_APPS_ADDR A:0x1e22070
y.create.l HWIO_APPS_SMMU_CB3_IPAFAR_LOW_APPS_ADDR A:0x1e23070
y.create.l HWIO_APPS_SMMU_CB4_IPAFAR_LOW_APPS_ADDR A:0x1e24070
y.create.l HWIO_APPS_SMMU_CB5_IPAFAR_LOW_APPS_ADDR A:0x1e25070
y.create.l HWIO_APPS_SMMU_CB6_IPAFAR_LOW_APPS_ADDR A:0x1e26070
y.create.l HWIO_APPS_SMMU_CB7_IPAFAR_LOW_APPS_ADDR A:0x1e27070
y.create.l HWIO_APPS_SMMU_CB8_IPAFAR_LOW_APPS_ADDR A:0x1e28070
y.create.l HWIO_APPS_SMMU_CB9_IPAFAR_LOW_APPS_ADDR A:0x1e29070
y.create.l HWIO_APPS_SMMU_CB10_IPAFAR_LOW_APPS_ADDR A:0x1e2a070
y.create.l HWIO_APPS_SMMU_CB11_IPAFAR_LOW_APPS_ADDR A:0x1e2b070
y.create.l HWIO_APPS_SMMU_CB12_IPAFAR_LOW_APPS_ADDR A:0x1e2c070
y.create.l HWIO_APPS_SMMU_CB13_IPAFAR_LOW_APPS_ADDR A:0x1e2d070
y.create.l HWIO_APPS_SMMU_CB14_IPAFAR_LOW_APPS_ADDR A:0x1e2e070
y.create.l HWIO_APPS_SMMU_CB15_IPAFAR_LOW_APPS_ADDR A:0x1e2f070
y.create.l HWIO_APPS_SMMU_CB16_IPAFAR_LOW_APPS_ADDR A:0x1e30070
y.create.l HWIO_APPS_SMMU_CB17_IPAFAR_LOW_APPS_ADDR A:0x1e31070
y.create.l HWIO_APPS_SMMU_CB18_IPAFAR_LOW_APPS_ADDR A:0x1e32070
y.create.l HWIO_APPS_SMMU_CB19_IPAFAR_LOW_APPS_ADDR A:0x1e33070
y.create.l HWIO_APPS_SMMU_CB20_IPAFAR_LOW_APPS_ADDR A:0x1e34070
y.create.l HWIO_APPS_SMMU_CB21_IPAFAR_LOW_APPS_ADDR A:0x1e35070
y.create.l HWIO_APPS_SMMU_CB22_IPAFAR_LOW_APPS_ADDR A:0x1e36070
y.create.l HWIO_APPS_SMMU_CB23_IPAFAR_LOW_APPS_ADDR A:0x1e37070
y.create.l HWIO_APPS_SMMU_CB24_IPAFAR_LOW_APPS_ADDR A:0x1e38070
y.create.l HWIO_APPS_SMMU_CB25_IPAFAR_LOW_APPS_ADDR A:0x1e39070
y.create.l HWIO_APPS_SMMU_CB26_IPAFAR_LOW_APPS_ADDR A:0x1e3a070
y.create.l HWIO_APPS_SMMU_CB27_IPAFAR_LOW_APPS_ADDR A:0x1e3b070
y.create.l HWIO_APPS_SMMU_CB28_IPAFAR_LOW_APPS_ADDR A:0x1e3c070
y.create.l HWIO_APPS_SMMU_CB29_IPAFAR_LOW_APPS_ADDR A:0x1e3d070
y.create.l HWIO_APPS_SMMU_CB30_IPAFAR_LOW_APPS_ADDR A:0x1e3e070
y.create.l HWIO_APPS_SMMU_CB31_IPAFAR_LOW_APPS_ADDR A:0x1e3f070
y.create.l HWIO_APPS_SMMU_CB0_IPAFAR_HIGH_APPS_ADDR A:0x1e20074
y.create.l HWIO_APPS_SMMU_CB1_IPAFAR_HIGH_APPS_ADDR A:0x1e21074
y.create.l HWIO_APPS_SMMU_CB2_IPAFAR_HIGH_APPS_ADDR A:0x1e22074
y.create.l HWIO_APPS_SMMU_CB3_IPAFAR_HIGH_APPS_ADDR A:0x1e23074
y.create.l HWIO_APPS_SMMU_CB4_IPAFAR_HIGH_APPS_ADDR A:0x1e24074
y.create.l HWIO_APPS_SMMU_CB5_IPAFAR_HIGH_APPS_ADDR A:0x1e25074
y.create.l HWIO_APPS_SMMU_CB6_IPAFAR_HIGH_APPS_ADDR A:0x1e26074
y.create.l HWIO_APPS_SMMU_CB7_IPAFAR_HIGH_APPS_ADDR A:0x1e27074
y.create.l HWIO_APPS_SMMU_CB8_IPAFAR_HIGH_APPS_ADDR A:0x1e28074
y.create.l HWIO_APPS_SMMU_CB9_IPAFAR_HIGH_APPS_ADDR A:0x1e29074
y.create.l HWIO_APPS_SMMU_CB10_IPAFAR_HIGH_APPS_ADDR A:0x1e2a074
y.create.l HWIO_APPS_SMMU_CB11_IPAFAR_HIGH_APPS_ADDR A:0x1e2b074
y.create.l HWIO_APPS_SMMU_CB12_IPAFAR_HIGH_APPS_ADDR A:0x1e2c074
y.create.l HWIO_APPS_SMMU_CB13_IPAFAR_HIGH_APPS_ADDR A:0x1e2d074
y.create.l HWIO_APPS_SMMU_CB14_IPAFAR_HIGH_APPS_ADDR A:0x1e2e074
y.create.l HWIO_APPS_SMMU_CB15_IPAFAR_HIGH_APPS_ADDR A:0x1e2f074
y.create.l HWIO_APPS_SMMU_CB16_IPAFAR_HIGH_APPS_ADDR A:0x1e30074
y.create.l HWIO_APPS_SMMU_CB17_IPAFAR_HIGH_APPS_ADDR A:0x1e31074
y.create.l HWIO_APPS_SMMU_CB18_IPAFAR_HIGH_APPS_ADDR A:0x1e32074
y.create.l HWIO_APPS_SMMU_CB19_IPAFAR_HIGH_APPS_ADDR A:0x1e33074
y.create.l HWIO_APPS_SMMU_CB20_IPAFAR_HIGH_APPS_ADDR A:0x1e34074
y.create.l HWIO_APPS_SMMU_CB21_IPAFAR_HIGH_APPS_ADDR A:0x1e35074
y.create.l HWIO_APPS_SMMU_CB22_IPAFAR_HIGH_APPS_ADDR A:0x1e36074
y.create.l HWIO_APPS_SMMU_CB23_IPAFAR_HIGH_APPS_ADDR A:0x1e37074
y.create.l HWIO_APPS_SMMU_CB24_IPAFAR_HIGH_APPS_ADDR A:0x1e38074
y.create.l HWIO_APPS_SMMU_CB25_IPAFAR_HIGH_APPS_ADDR A:0x1e39074
y.create.l HWIO_APPS_SMMU_CB26_IPAFAR_HIGH_APPS_ADDR A:0x1e3a074
y.create.l HWIO_APPS_SMMU_CB27_IPAFAR_HIGH_APPS_ADDR A:0x1e3b074
y.create.l HWIO_APPS_SMMU_CB28_IPAFAR_HIGH_APPS_ADDR A:0x1e3c074
y.create.l HWIO_APPS_SMMU_CB29_IPAFAR_HIGH_APPS_ADDR A:0x1e3d074
y.create.l HWIO_APPS_SMMU_CB30_IPAFAR_HIGH_APPS_ADDR A:0x1e3e074
y.create.l HWIO_APPS_SMMU_CB31_IPAFAR_HIGH_APPS_ADDR A:0x1e3f074
y.create.l HWIO_APPS_SMMU_CB0_TLBIVA_LOW_APPS_ADDR A:0x1e20600
y.create.l HWIO_APPS_SMMU_CB1_TLBIVA_LOW_APPS_ADDR A:0x1e21600
y.create.l HWIO_APPS_SMMU_CB2_TLBIVA_LOW_APPS_ADDR A:0x1e22600
y.create.l HWIO_APPS_SMMU_CB3_TLBIVA_LOW_APPS_ADDR A:0x1e23600
y.create.l HWIO_APPS_SMMU_CB4_TLBIVA_LOW_APPS_ADDR A:0x1e24600
y.create.l HWIO_APPS_SMMU_CB5_TLBIVA_LOW_APPS_ADDR A:0x1e25600
y.create.l HWIO_APPS_SMMU_CB6_TLBIVA_LOW_APPS_ADDR A:0x1e26600
y.create.l HWIO_APPS_SMMU_CB7_TLBIVA_LOW_APPS_ADDR A:0x1e27600
y.create.l HWIO_APPS_SMMU_CB8_TLBIVA_LOW_APPS_ADDR A:0x1e28600
y.create.l HWIO_APPS_SMMU_CB9_TLBIVA_LOW_APPS_ADDR A:0x1e29600
y.create.l HWIO_APPS_SMMU_CB10_TLBIVA_LOW_APPS_ADDR A:0x1e2a600
y.create.l HWIO_APPS_SMMU_CB11_TLBIVA_LOW_APPS_ADDR A:0x1e2b600
y.create.l HWIO_APPS_SMMU_CB12_TLBIVA_LOW_APPS_ADDR A:0x1e2c600
y.create.l HWIO_APPS_SMMU_CB13_TLBIVA_LOW_APPS_ADDR A:0x1e2d600
y.create.l HWIO_APPS_SMMU_CB14_TLBIVA_LOW_APPS_ADDR A:0x1e2e600
y.create.l HWIO_APPS_SMMU_CB15_TLBIVA_LOW_APPS_ADDR A:0x1e2f600
y.create.l HWIO_APPS_SMMU_CB16_TLBIVA_LOW_APPS_ADDR A:0x1e30600
y.create.l HWIO_APPS_SMMU_CB17_TLBIVA_LOW_APPS_ADDR A:0x1e31600
y.create.l HWIO_APPS_SMMU_CB18_TLBIVA_LOW_APPS_ADDR A:0x1e32600
y.create.l HWIO_APPS_SMMU_CB19_TLBIVA_LOW_APPS_ADDR A:0x1e33600
y.create.l HWIO_APPS_SMMU_CB20_TLBIVA_LOW_APPS_ADDR A:0x1e34600
y.create.l HWIO_APPS_SMMU_CB21_TLBIVA_LOW_APPS_ADDR A:0x1e35600
y.create.l HWIO_APPS_SMMU_CB22_TLBIVA_LOW_APPS_ADDR A:0x1e36600
y.create.l HWIO_APPS_SMMU_CB23_TLBIVA_LOW_APPS_ADDR A:0x1e37600
y.create.l HWIO_APPS_SMMU_CB24_TLBIVA_LOW_APPS_ADDR A:0x1e38600
y.create.l HWIO_APPS_SMMU_CB25_TLBIVA_LOW_APPS_ADDR A:0x1e39600
y.create.l HWIO_APPS_SMMU_CB26_TLBIVA_LOW_APPS_ADDR A:0x1e3a600
y.create.l HWIO_APPS_SMMU_CB27_TLBIVA_LOW_APPS_ADDR A:0x1e3b600
y.create.l HWIO_APPS_SMMU_CB28_TLBIVA_LOW_APPS_ADDR A:0x1e3c600
y.create.l HWIO_APPS_SMMU_CB29_TLBIVA_LOW_APPS_ADDR A:0x1e3d600
y.create.l HWIO_APPS_SMMU_CB30_TLBIVA_LOW_APPS_ADDR A:0x1e3e600
y.create.l HWIO_APPS_SMMU_CB31_TLBIVA_LOW_APPS_ADDR A:0x1e3f600
y.create.l HWIO_APPS_SMMU_CB0_TLBIVA_HIGH_APPS_ADDR A:0x1e20604
y.create.l HWIO_APPS_SMMU_CB1_TLBIVA_HIGH_APPS_ADDR A:0x1e21604
y.create.l HWIO_APPS_SMMU_CB2_TLBIVA_HIGH_APPS_ADDR A:0x1e22604
y.create.l HWIO_APPS_SMMU_CB3_TLBIVA_HIGH_APPS_ADDR A:0x1e23604
y.create.l HWIO_APPS_SMMU_CB4_TLBIVA_HIGH_APPS_ADDR A:0x1e24604
y.create.l HWIO_APPS_SMMU_CB5_TLBIVA_HIGH_APPS_ADDR A:0x1e25604
y.create.l HWIO_APPS_SMMU_CB6_TLBIVA_HIGH_APPS_ADDR A:0x1e26604
y.create.l HWIO_APPS_SMMU_CB7_TLBIVA_HIGH_APPS_ADDR A:0x1e27604
y.create.l HWIO_APPS_SMMU_CB8_TLBIVA_HIGH_APPS_ADDR A:0x1e28604
y.create.l HWIO_APPS_SMMU_CB9_TLBIVA_HIGH_APPS_ADDR A:0x1e29604
y.create.l HWIO_APPS_SMMU_CB10_TLBIVA_HIGH_APPS_ADDR A:0x1e2a604
y.create.l HWIO_APPS_SMMU_CB11_TLBIVA_HIGH_APPS_ADDR A:0x1e2b604
y.create.l HWIO_APPS_SMMU_CB12_TLBIVA_HIGH_APPS_ADDR A:0x1e2c604
y.create.l HWIO_APPS_SMMU_CB13_TLBIVA_HIGH_APPS_ADDR A:0x1e2d604
y.create.l HWIO_APPS_SMMU_CB14_TLBIVA_HIGH_APPS_ADDR A:0x1e2e604
y.create.l HWIO_APPS_SMMU_CB15_TLBIVA_HIGH_APPS_ADDR A:0x1e2f604
y.create.l HWIO_APPS_SMMU_CB16_TLBIVA_HIGH_APPS_ADDR A:0x1e30604
y.create.l HWIO_APPS_SMMU_CB17_TLBIVA_HIGH_APPS_ADDR A:0x1e31604
y.create.l HWIO_APPS_SMMU_CB18_TLBIVA_HIGH_APPS_ADDR A:0x1e32604
y.create.l HWIO_APPS_SMMU_CB19_TLBIVA_HIGH_APPS_ADDR A:0x1e33604
y.create.l HWIO_APPS_SMMU_CB20_TLBIVA_HIGH_APPS_ADDR A:0x1e34604
y.create.l HWIO_APPS_SMMU_CB21_TLBIVA_HIGH_APPS_ADDR A:0x1e35604
y.create.l HWIO_APPS_SMMU_CB22_TLBIVA_HIGH_APPS_ADDR A:0x1e36604
y.create.l HWIO_APPS_SMMU_CB23_TLBIVA_HIGH_APPS_ADDR A:0x1e37604
y.create.l HWIO_APPS_SMMU_CB24_TLBIVA_HIGH_APPS_ADDR A:0x1e38604
y.create.l HWIO_APPS_SMMU_CB25_TLBIVA_HIGH_APPS_ADDR A:0x1e39604
y.create.l HWIO_APPS_SMMU_CB26_TLBIVA_HIGH_APPS_ADDR A:0x1e3a604
y.create.l HWIO_APPS_SMMU_CB27_TLBIVA_HIGH_APPS_ADDR A:0x1e3b604
y.create.l HWIO_APPS_SMMU_CB28_TLBIVA_HIGH_APPS_ADDR A:0x1e3c604
y.create.l HWIO_APPS_SMMU_CB29_TLBIVA_HIGH_APPS_ADDR A:0x1e3d604
y.create.l HWIO_APPS_SMMU_CB30_TLBIVA_HIGH_APPS_ADDR A:0x1e3e604
y.create.l HWIO_APPS_SMMU_CB31_TLBIVA_HIGH_APPS_ADDR A:0x1e3f604
y.create.l HWIO_APPS_SMMU_CB0_TLBIVAA_LOW_APPS_ADDR A:0x1e20608
y.create.l HWIO_APPS_SMMU_CB1_TLBIVAA_LOW_APPS_ADDR A:0x1e21608
y.create.l HWIO_APPS_SMMU_CB2_TLBIVAA_LOW_APPS_ADDR A:0x1e22608
y.create.l HWIO_APPS_SMMU_CB3_TLBIVAA_LOW_APPS_ADDR A:0x1e23608
y.create.l HWIO_APPS_SMMU_CB4_TLBIVAA_LOW_APPS_ADDR A:0x1e24608
y.create.l HWIO_APPS_SMMU_CB5_TLBIVAA_LOW_APPS_ADDR A:0x1e25608
y.create.l HWIO_APPS_SMMU_CB6_TLBIVAA_LOW_APPS_ADDR A:0x1e26608
y.create.l HWIO_APPS_SMMU_CB7_TLBIVAA_LOW_APPS_ADDR A:0x1e27608
y.create.l HWIO_APPS_SMMU_CB8_TLBIVAA_LOW_APPS_ADDR A:0x1e28608
y.create.l HWIO_APPS_SMMU_CB9_TLBIVAA_LOW_APPS_ADDR A:0x1e29608
y.create.l HWIO_APPS_SMMU_CB10_TLBIVAA_LOW_APPS_ADDR A:0x1e2a608
y.create.l HWIO_APPS_SMMU_CB11_TLBIVAA_LOW_APPS_ADDR A:0x1e2b608
y.create.l HWIO_APPS_SMMU_CB12_TLBIVAA_LOW_APPS_ADDR A:0x1e2c608
y.create.l HWIO_APPS_SMMU_CB13_TLBIVAA_LOW_APPS_ADDR A:0x1e2d608
y.create.l HWIO_APPS_SMMU_CB14_TLBIVAA_LOW_APPS_ADDR A:0x1e2e608
y.create.l HWIO_APPS_SMMU_CB15_TLBIVAA_LOW_APPS_ADDR A:0x1e2f608
y.create.l HWIO_APPS_SMMU_CB16_TLBIVAA_LOW_APPS_ADDR A:0x1e30608
y.create.l HWIO_APPS_SMMU_CB17_TLBIVAA_LOW_APPS_ADDR A:0x1e31608
y.create.l HWIO_APPS_SMMU_CB18_TLBIVAA_LOW_APPS_ADDR A:0x1e32608
y.create.l HWIO_APPS_SMMU_CB19_TLBIVAA_LOW_APPS_ADDR A:0x1e33608
y.create.l HWIO_APPS_SMMU_CB20_TLBIVAA_LOW_APPS_ADDR A:0x1e34608
y.create.l HWIO_APPS_SMMU_CB21_TLBIVAA_LOW_APPS_ADDR A:0x1e35608
y.create.l HWIO_APPS_SMMU_CB22_TLBIVAA_LOW_APPS_ADDR A:0x1e36608
y.create.l HWIO_APPS_SMMU_CB23_TLBIVAA_LOW_APPS_ADDR A:0x1e37608
y.create.l HWIO_APPS_SMMU_CB24_TLBIVAA_LOW_APPS_ADDR A:0x1e38608
y.create.l HWIO_APPS_SMMU_CB25_TLBIVAA_LOW_APPS_ADDR A:0x1e39608
y.create.l HWIO_APPS_SMMU_CB26_TLBIVAA_LOW_APPS_ADDR A:0x1e3a608
y.create.l HWIO_APPS_SMMU_CB27_TLBIVAA_LOW_APPS_ADDR A:0x1e3b608
y.create.l HWIO_APPS_SMMU_CB28_TLBIVAA_LOW_APPS_ADDR A:0x1e3c608
y.create.l HWIO_APPS_SMMU_CB29_TLBIVAA_LOW_APPS_ADDR A:0x1e3d608
y.create.l HWIO_APPS_SMMU_CB30_TLBIVAA_LOW_APPS_ADDR A:0x1e3e608
y.create.l HWIO_APPS_SMMU_CB31_TLBIVAA_LOW_APPS_ADDR A:0x1e3f608
y.create.l HWIO_APPS_SMMU_CB0_TLBIVAA_HIGH_APPS_ADDR A:0x1e2060c
y.create.l HWIO_APPS_SMMU_CB1_TLBIVAA_HIGH_APPS_ADDR A:0x1e2160c
y.create.l HWIO_APPS_SMMU_CB2_TLBIVAA_HIGH_APPS_ADDR A:0x1e2260c
y.create.l HWIO_APPS_SMMU_CB3_TLBIVAA_HIGH_APPS_ADDR A:0x1e2360c
y.create.l HWIO_APPS_SMMU_CB4_TLBIVAA_HIGH_APPS_ADDR A:0x1e2460c
y.create.l HWIO_APPS_SMMU_CB5_TLBIVAA_HIGH_APPS_ADDR A:0x1e2560c
y.create.l HWIO_APPS_SMMU_CB6_TLBIVAA_HIGH_APPS_ADDR A:0x1e2660c
y.create.l HWIO_APPS_SMMU_CB7_TLBIVAA_HIGH_APPS_ADDR A:0x1e2760c
y.create.l HWIO_APPS_SMMU_CB8_TLBIVAA_HIGH_APPS_ADDR A:0x1e2860c
y.create.l HWIO_APPS_SMMU_CB9_TLBIVAA_HIGH_APPS_ADDR A:0x1e2960c
y.create.l HWIO_APPS_SMMU_CB10_TLBIVAA_HIGH_APPS_ADDR A:0x1e2a60c
y.create.l HWIO_APPS_SMMU_CB11_TLBIVAA_HIGH_APPS_ADDR A:0x1e2b60c
y.create.l HWIO_APPS_SMMU_CB12_TLBIVAA_HIGH_APPS_ADDR A:0x1e2c60c
y.create.l HWIO_APPS_SMMU_CB13_TLBIVAA_HIGH_APPS_ADDR A:0x1e2d60c
y.create.l HWIO_APPS_SMMU_CB14_TLBIVAA_HIGH_APPS_ADDR A:0x1e2e60c
y.create.l HWIO_APPS_SMMU_CB15_TLBIVAA_HIGH_APPS_ADDR A:0x1e2f60c
y.create.l HWIO_APPS_SMMU_CB16_TLBIVAA_HIGH_APPS_ADDR A:0x1e3060c
y.create.l HWIO_APPS_SMMU_CB17_TLBIVAA_HIGH_APPS_ADDR A:0x1e3160c
y.create.l HWIO_APPS_SMMU_CB18_TLBIVAA_HIGH_APPS_ADDR A:0x1e3260c
y.create.l HWIO_APPS_SMMU_CB19_TLBIVAA_HIGH_APPS_ADDR A:0x1e3360c
y.create.l HWIO_APPS_SMMU_CB20_TLBIVAA_HIGH_APPS_ADDR A:0x1e3460c
y.create.l HWIO_APPS_SMMU_CB21_TLBIVAA_HIGH_APPS_ADDR A:0x1e3560c
y.create.l HWIO_APPS_SMMU_CB22_TLBIVAA_HIGH_APPS_ADDR A:0x1e3660c
y.create.l HWIO_APPS_SMMU_CB23_TLBIVAA_HIGH_APPS_ADDR A:0x1e3760c
y.create.l HWIO_APPS_SMMU_CB24_TLBIVAA_HIGH_APPS_ADDR A:0x1e3860c
y.create.l HWIO_APPS_SMMU_CB25_TLBIVAA_HIGH_APPS_ADDR A:0x1e3960c
y.create.l HWIO_APPS_SMMU_CB26_TLBIVAA_HIGH_APPS_ADDR A:0x1e3a60c
y.create.l HWIO_APPS_SMMU_CB27_TLBIVAA_HIGH_APPS_ADDR A:0x1e3b60c
y.create.l HWIO_APPS_SMMU_CB28_TLBIVAA_HIGH_APPS_ADDR A:0x1e3c60c
y.create.l HWIO_APPS_SMMU_CB29_TLBIVAA_HIGH_APPS_ADDR A:0x1e3d60c
y.create.l HWIO_APPS_SMMU_CB30_TLBIVAA_HIGH_APPS_ADDR A:0x1e3e60c
y.create.l HWIO_APPS_SMMU_CB31_TLBIVAA_HIGH_APPS_ADDR A:0x1e3f60c
y.create.l HWIO_APPS_SMMU_CB0_TLBIASID_APPS_ADDR A:0x1e20610
y.create.l HWIO_APPS_SMMU_CB1_TLBIASID_APPS_ADDR A:0x1e21610
y.create.l HWIO_APPS_SMMU_CB2_TLBIASID_APPS_ADDR A:0x1e22610
y.create.l HWIO_APPS_SMMU_CB3_TLBIASID_APPS_ADDR A:0x1e23610
y.create.l HWIO_APPS_SMMU_CB4_TLBIASID_APPS_ADDR A:0x1e24610
y.create.l HWIO_APPS_SMMU_CB5_TLBIASID_APPS_ADDR A:0x1e25610
y.create.l HWIO_APPS_SMMU_CB6_TLBIASID_APPS_ADDR A:0x1e26610
y.create.l HWIO_APPS_SMMU_CB7_TLBIASID_APPS_ADDR A:0x1e27610
y.create.l HWIO_APPS_SMMU_CB8_TLBIASID_APPS_ADDR A:0x1e28610
y.create.l HWIO_APPS_SMMU_CB9_TLBIASID_APPS_ADDR A:0x1e29610
y.create.l HWIO_APPS_SMMU_CB10_TLBIASID_APPS_ADDR A:0x1e2a610
y.create.l HWIO_APPS_SMMU_CB11_TLBIASID_APPS_ADDR A:0x1e2b610
y.create.l HWIO_APPS_SMMU_CB12_TLBIASID_APPS_ADDR A:0x1e2c610
y.create.l HWIO_APPS_SMMU_CB13_TLBIASID_APPS_ADDR A:0x1e2d610
y.create.l HWIO_APPS_SMMU_CB14_TLBIASID_APPS_ADDR A:0x1e2e610
y.create.l HWIO_APPS_SMMU_CB15_TLBIASID_APPS_ADDR A:0x1e2f610
y.create.l HWIO_APPS_SMMU_CB16_TLBIASID_APPS_ADDR A:0x1e30610
y.create.l HWIO_APPS_SMMU_CB17_TLBIASID_APPS_ADDR A:0x1e31610
y.create.l HWIO_APPS_SMMU_CB18_TLBIASID_APPS_ADDR A:0x1e32610
y.create.l HWIO_APPS_SMMU_CB19_TLBIASID_APPS_ADDR A:0x1e33610
y.create.l HWIO_APPS_SMMU_CB20_TLBIASID_APPS_ADDR A:0x1e34610
y.create.l HWIO_APPS_SMMU_CB21_TLBIASID_APPS_ADDR A:0x1e35610
y.create.l HWIO_APPS_SMMU_CB22_TLBIASID_APPS_ADDR A:0x1e36610
y.create.l HWIO_APPS_SMMU_CB23_TLBIASID_APPS_ADDR A:0x1e37610
y.create.l HWIO_APPS_SMMU_CB24_TLBIASID_APPS_ADDR A:0x1e38610
y.create.l HWIO_APPS_SMMU_CB25_TLBIASID_APPS_ADDR A:0x1e39610
y.create.l HWIO_APPS_SMMU_CB26_TLBIASID_APPS_ADDR A:0x1e3a610
y.create.l HWIO_APPS_SMMU_CB27_TLBIASID_APPS_ADDR A:0x1e3b610
y.create.l HWIO_APPS_SMMU_CB28_TLBIASID_APPS_ADDR A:0x1e3c610
y.create.l HWIO_APPS_SMMU_CB29_TLBIASID_APPS_ADDR A:0x1e3d610
y.create.l HWIO_APPS_SMMU_CB30_TLBIASID_APPS_ADDR A:0x1e3e610
y.create.l HWIO_APPS_SMMU_CB31_TLBIASID_APPS_ADDR A:0x1e3f610
y.create.l HWIO_APPS_SMMU_CB0_TLBIALL_APPS_ADDR A:0x1e20618
y.create.l HWIO_APPS_SMMU_CB1_TLBIALL_APPS_ADDR A:0x1e21618
y.create.l HWIO_APPS_SMMU_CB2_TLBIALL_APPS_ADDR A:0x1e22618
y.create.l HWIO_APPS_SMMU_CB3_TLBIALL_APPS_ADDR A:0x1e23618
y.create.l HWIO_APPS_SMMU_CB4_TLBIALL_APPS_ADDR A:0x1e24618
y.create.l HWIO_APPS_SMMU_CB5_TLBIALL_APPS_ADDR A:0x1e25618
y.create.l HWIO_APPS_SMMU_CB6_TLBIALL_APPS_ADDR A:0x1e26618
y.create.l HWIO_APPS_SMMU_CB7_TLBIALL_APPS_ADDR A:0x1e27618
y.create.l HWIO_APPS_SMMU_CB8_TLBIALL_APPS_ADDR A:0x1e28618
y.create.l HWIO_APPS_SMMU_CB9_TLBIALL_APPS_ADDR A:0x1e29618
y.create.l HWIO_APPS_SMMU_CB10_TLBIALL_APPS_ADDR A:0x1e2a618
y.create.l HWIO_APPS_SMMU_CB11_TLBIALL_APPS_ADDR A:0x1e2b618
y.create.l HWIO_APPS_SMMU_CB12_TLBIALL_APPS_ADDR A:0x1e2c618
y.create.l HWIO_APPS_SMMU_CB13_TLBIALL_APPS_ADDR A:0x1e2d618
y.create.l HWIO_APPS_SMMU_CB14_TLBIALL_APPS_ADDR A:0x1e2e618
y.create.l HWIO_APPS_SMMU_CB15_TLBIALL_APPS_ADDR A:0x1e2f618
y.create.l HWIO_APPS_SMMU_CB16_TLBIALL_APPS_ADDR A:0x1e30618
y.create.l HWIO_APPS_SMMU_CB17_TLBIALL_APPS_ADDR A:0x1e31618
y.create.l HWIO_APPS_SMMU_CB18_TLBIALL_APPS_ADDR A:0x1e32618
y.create.l HWIO_APPS_SMMU_CB19_TLBIALL_APPS_ADDR A:0x1e33618
y.create.l HWIO_APPS_SMMU_CB20_TLBIALL_APPS_ADDR A:0x1e34618
y.create.l HWIO_APPS_SMMU_CB21_TLBIALL_APPS_ADDR A:0x1e35618
y.create.l HWIO_APPS_SMMU_CB22_TLBIALL_APPS_ADDR A:0x1e36618
y.create.l HWIO_APPS_SMMU_CB23_TLBIALL_APPS_ADDR A:0x1e37618
y.create.l HWIO_APPS_SMMU_CB24_TLBIALL_APPS_ADDR A:0x1e38618
y.create.l HWIO_APPS_SMMU_CB25_TLBIALL_APPS_ADDR A:0x1e39618
y.create.l HWIO_APPS_SMMU_CB26_TLBIALL_APPS_ADDR A:0x1e3a618
y.create.l HWIO_APPS_SMMU_CB27_TLBIALL_APPS_ADDR A:0x1e3b618
y.create.l HWIO_APPS_SMMU_CB28_TLBIALL_APPS_ADDR A:0x1e3c618
y.create.l HWIO_APPS_SMMU_CB29_TLBIALL_APPS_ADDR A:0x1e3d618
y.create.l HWIO_APPS_SMMU_CB30_TLBIALL_APPS_ADDR A:0x1e3e618
y.create.l HWIO_APPS_SMMU_CB31_TLBIALL_APPS_ADDR A:0x1e3f618
y.create.l HWIO_APPS_SMMU_CB0_TLBIVAL_LOW_APPS_ADDR A:0x1e20620
y.create.l HWIO_APPS_SMMU_CB1_TLBIVAL_LOW_APPS_ADDR A:0x1e21620
y.create.l HWIO_APPS_SMMU_CB2_TLBIVAL_LOW_APPS_ADDR A:0x1e22620
y.create.l HWIO_APPS_SMMU_CB3_TLBIVAL_LOW_APPS_ADDR A:0x1e23620
y.create.l HWIO_APPS_SMMU_CB4_TLBIVAL_LOW_APPS_ADDR A:0x1e24620
y.create.l HWIO_APPS_SMMU_CB5_TLBIVAL_LOW_APPS_ADDR A:0x1e25620
y.create.l HWIO_APPS_SMMU_CB6_TLBIVAL_LOW_APPS_ADDR A:0x1e26620
y.create.l HWIO_APPS_SMMU_CB7_TLBIVAL_LOW_APPS_ADDR A:0x1e27620
y.create.l HWIO_APPS_SMMU_CB8_TLBIVAL_LOW_APPS_ADDR A:0x1e28620
y.create.l HWIO_APPS_SMMU_CB9_TLBIVAL_LOW_APPS_ADDR A:0x1e29620
y.create.l HWIO_APPS_SMMU_CB10_TLBIVAL_LOW_APPS_ADDR A:0x1e2a620
y.create.l HWIO_APPS_SMMU_CB11_TLBIVAL_LOW_APPS_ADDR A:0x1e2b620
y.create.l HWIO_APPS_SMMU_CB12_TLBIVAL_LOW_APPS_ADDR A:0x1e2c620
y.create.l HWIO_APPS_SMMU_CB13_TLBIVAL_LOW_APPS_ADDR A:0x1e2d620
y.create.l HWIO_APPS_SMMU_CB14_TLBIVAL_LOW_APPS_ADDR A:0x1e2e620
y.create.l HWIO_APPS_SMMU_CB15_TLBIVAL_LOW_APPS_ADDR A:0x1e2f620
y.create.l HWIO_APPS_SMMU_CB16_TLBIVAL_LOW_APPS_ADDR A:0x1e30620
y.create.l HWIO_APPS_SMMU_CB17_TLBIVAL_LOW_APPS_ADDR A:0x1e31620
y.create.l HWIO_APPS_SMMU_CB18_TLBIVAL_LOW_APPS_ADDR A:0x1e32620
y.create.l HWIO_APPS_SMMU_CB19_TLBIVAL_LOW_APPS_ADDR A:0x1e33620
y.create.l HWIO_APPS_SMMU_CB20_TLBIVAL_LOW_APPS_ADDR A:0x1e34620
y.create.l HWIO_APPS_SMMU_CB21_TLBIVAL_LOW_APPS_ADDR A:0x1e35620
y.create.l HWIO_APPS_SMMU_CB22_TLBIVAL_LOW_APPS_ADDR A:0x1e36620
y.create.l HWIO_APPS_SMMU_CB23_TLBIVAL_LOW_APPS_ADDR A:0x1e37620
y.create.l HWIO_APPS_SMMU_CB24_TLBIVAL_LOW_APPS_ADDR A:0x1e38620
y.create.l HWIO_APPS_SMMU_CB25_TLBIVAL_LOW_APPS_ADDR A:0x1e39620
y.create.l HWIO_APPS_SMMU_CB26_TLBIVAL_LOW_APPS_ADDR A:0x1e3a620
y.create.l HWIO_APPS_SMMU_CB27_TLBIVAL_LOW_APPS_ADDR A:0x1e3b620
y.create.l HWIO_APPS_SMMU_CB28_TLBIVAL_LOW_APPS_ADDR A:0x1e3c620
y.create.l HWIO_APPS_SMMU_CB29_TLBIVAL_LOW_APPS_ADDR A:0x1e3d620
y.create.l HWIO_APPS_SMMU_CB30_TLBIVAL_LOW_APPS_ADDR A:0x1e3e620
y.create.l HWIO_APPS_SMMU_CB31_TLBIVAL_LOW_APPS_ADDR A:0x1e3f620
y.create.l HWIO_APPS_SMMU_CB0_TLBIVAL_HIGH_APPS_ADDR A:0x1e20624
y.create.l HWIO_APPS_SMMU_CB1_TLBIVAL_HIGH_APPS_ADDR A:0x1e21624
y.create.l HWIO_APPS_SMMU_CB2_TLBIVAL_HIGH_APPS_ADDR A:0x1e22624
y.create.l HWIO_APPS_SMMU_CB3_TLBIVAL_HIGH_APPS_ADDR A:0x1e23624
y.create.l HWIO_APPS_SMMU_CB4_TLBIVAL_HIGH_APPS_ADDR A:0x1e24624
y.create.l HWIO_APPS_SMMU_CB5_TLBIVAL_HIGH_APPS_ADDR A:0x1e25624
y.create.l HWIO_APPS_SMMU_CB6_TLBIVAL_HIGH_APPS_ADDR A:0x1e26624
y.create.l HWIO_APPS_SMMU_CB7_TLBIVAL_HIGH_APPS_ADDR A:0x1e27624
y.create.l HWIO_APPS_SMMU_CB8_TLBIVAL_HIGH_APPS_ADDR A:0x1e28624
y.create.l HWIO_APPS_SMMU_CB9_TLBIVAL_HIGH_APPS_ADDR A:0x1e29624
y.create.l HWIO_APPS_SMMU_CB10_TLBIVAL_HIGH_APPS_ADDR A:0x1e2a624
y.create.l HWIO_APPS_SMMU_CB11_TLBIVAL_HIGH_APPS_ADDR A:0x1e2b624
y.create.l HWIO_APPS_SMMU_CB12_TLBIVAL_HIGH_APPS_ADDR A:0x1e2c624
y.create.l HWIO_APPS_SMMU_CB13_TLBIVAL_HIGH_APPS_ADDR A:0x1e2d624
y.create.l HWIO_APPS_SMMU_CB14_TLBIVAL_HIGH_APPS_ADDR A:0x1e2e624
y.create.l HWIO_APPS_SMMU_CB15_TLBIVAL_HIGH_APPS_ADDR A:0x1e2f624
y.create.l HWIO_APPS_SMMU_CB16_TLBIVAL_HIGH_APPS_ADDR A:0x1e30624
y.create.l HWIO_APPS_SMMU_CB17_TLBIVAL_HIGH_APPS_ADDR A:0x1e31624
y.create.l HWIO_APPS_SMMU_CB18_TLBIVAL_HIGH_APPS_ADDR A:0x1e32624
y.create.l HWIO_APPS_SMMU_CB19_TLBIVAL_HIGH_APPS_ADDR A:0x1e33624
y.create.l HWIO_APPS_SMMU_CB20_TLBIVAL_HIGH_APPS_ADDR A:0x1e34624
y.create.l HWIO_APPS_SMMU_CB21_TLBIVAL_HIGH_APPS_ADDR A:0x1e35624
y.create.l HWIO_APPS_SMMU_CB22_TLBIVAL_HIGH_APPS_ADDR A:0x1e36624
y.create.l HWIO_APPS_SMMU_CB23_TLBIVAL_HIGH_APPS_ADDR A:0x1e37624
y.create.l HWIO_APPS_SMMU_CB24_TLBIVAL_HIGH_APPS_ADDR A:0x1e38624
y.create.l HWIO_APPS_SMMU_CB25_TLBIVAL_HIGH_APPS_ADDR A:0x1e39624
y.create.l HWIO_APPS_SMMU_CB26_TLBIVAL_HIGH_APPS_ADDR A:0x1e3a624
y.create.l HWIO_APPS_SMMU_CB27_TLBIVAL_HIGH_APPS_ADDR A:0x1e3b624
y.create.l HWIO_APPS_SMMU_CB28_TLBIVAL_HIGH_APPS_ADDR A:0x1e3c624
y.create.l HWIO_APPS_SMMU_CB29_TLBIVAL_HIGH_APPS_ADDR A:0x1e3d624
y.create.l HWIO_APPS_SMMU_CB30_TLBIVAL_HIGH_APPS_ADDR A:0x1e3e624
y.create.l HWIO_APPS_SMMU_CB31_TLBIVAL_HIGH_APPS_ADDR A:0x1e3f624
y.create.l HWIO_APPS_SMMU_CB0_TLBIVAAL_LOW_APPS_ADDR A:0x1e20628
y.create.l HWIO_APPS_SMMU_CB1_TLBIVAAL_LOW_APPS_ADDR A:0x1e21628
y.create.l HWIO_APPS_SMMU_CB2_TLBIVAAL_LOW_APPS_ADDR A:0x1e22628
y.create.l HWIO_APPS_SMMU_CB3_TLBIVAAL_LOW_APPS_ADDR A:0x1e23628
y.create.l HWIO_APPS_SMMU_CB4_TLBIVAAL_LOW_APPS_ADDR A:0x1e24628
y.create.l HWIO_APPS_SMMU_CB5_TLBIVAAL_LOW_APPS_ADDR A:0x1e25628
y.create.l HWIO_APPS_SMMU_CB6_TLBIVAAL_LOW_APPS_ADDR A:0x1e26628
y.create.l HWIO_APPS_SMMU_CB7_TLBIVAAL_LOW_APPS_ADDR A:0x1e27628
y.create.l HWIO_APPS_SMMU_CB8_TLBIVAAL_LOW_APPS_ADDR A:0x1e28628
y.create.l HWIO_APPS_SMMU_CB9_TLBIVAAL_LOW_APPS_ADDR A:0x1e29628
y.create.l HWIO_APPS_SMMU_CB10_TLBIVAAL_LOW_APPS_ADDR A:0x1e2a628
y.create.l HWIO_APPS_SMMU_CB11_TLBIVAAL_LOW_APPS_ADDR A:0x1e2b628
y.create.l HWIO_APPS_SMMU_CB12_TLBIVAAL_LOW_APPS_ADDR A:0x1e2c628
y.create.l HWIO_APPS_SMMU_CB13_TLBIVAAL_LOW_APPS_ADDR A:0x1e2d628
y.create.l HWIO_APPS_SMMU_CB14_TLBIVAAL_LOW_APPS_ADDR A:0x1e2e628
y.create.l HWIO_APPS_SMMU_CB15_TLBIVAAL_LOW_APPS_ADDR A:0x1e2f628
y.create.l HWIO_APPS_SMMU_CB16_TLBIVAAL_LOW_APPS_ADDR A:0x1e30628
y.create.l HWIO_APPS_SMMU_CB17_TLBIVAAL_LOW_APPS_ADDR A:0x1e31628
y.create.l HWIO_APPS_SMMU_CB18_TLBIVAAL_LOW_APPS_ADDR A:0x1e32628
y.create.l HWIO_APPS_SMMU_CB19_TLBIVAAL_LOW_APPS_ADDR A:0x1e33628
y.create.l HWIO_APPS_SMMU_CB20_TLBIVAAL_LOW_APPS_ADDR A:0x1e34628
y.create.l HWIO_APPS_SMMU_CB21_TLBIVAAL_LOW_APPS_ADDR A:0x1e35628
y.create.l HWIO_APPS_SMMU_CB22_TLBIVAAL_LOW_APPS_ADDR A:0x1e36628
y.create.l HWIO_APPS_SMMU_CB23_TLBIVAAL_LOW_APPS_ADDR A:0x1e37628
y.create.l HWIO_APPS_SMMU_CB24_TLBIVAAL_LOW_APPS_ADDR A:0x1e38628
y.create.l HWIO_APPS_SMMU_CB25_TLBIVAAL_LOW_APPS_ADDR A:0x1e39628
y.create.l HWIO_APPS_SMMU_CB26_TLBIVAAL_LOW_APPS_ADDR A:0x1e3a628
y.create.l HWIO_APPS_SMMU_CB27_TLBIVAAL_LOW_APPS_ADDR A:0x1e3b628
y.create.l HWIO_APPS_SMMU_CB28_TLBIVAAL_LOW_APPS_ADDR A:0x1e3c628
y.create.l HWIO_APPS_SMMU_CB29_TLBIVAAL_LOW_APPS_ADDR A:0x1e3d628
y.create.l HWIO_APPS_SMMU_CB30_TLBIVAAL_LOW_APPS_ADDR A:0x1e3e628
y.create.l HWIO_APPS_SMMU_CB31_TLBIVAAL_LOW_APPS_ADDR A:0x1e3f628
y.create.l HWIO_APPS_SMMU_CB0_TLBIVAAL_HIGH_APPS_ADDR A:0x1e2062c
y.create.l HWIO_APPS_SMMU_CB1_TLBIVAAL_HIGH_APPS_ADDR A:0x1e2162c
y.create.l HWIO_APPS_SMMU_CB2_TLBIVAAL_HIGH_APPS_ADDR A:0x1e2262c
y.create.l HWIO_APPS_SMMU_CB3_TLBIVAAL_HIGH_APPS_ADDR A:0x1e2362c
y.create.l HWIO_APPS_SMMU_CB4_TLBIVAAL_HIGH_APPS_ADDR A:0x1e2462c
y.create.l HWIO_APPS_SMMU_CB5_TLBIVAAL_HIGH_APPS_ADDR A:0x1e2562c
y.create.l HWIO_APPS_SMMU_CB6_TLBIVAAL_HIGH_APPS_ADDR A:0x1e2662c
y.create.l HWIO_APPS_SMMU_CB7_TLBIVAAL_HIGH_APPS_ADDR A:0x1e2762c
y.create.l HWIO_APPS_SMMU_CB8_TLBIVAAL_HIGH_APPS_ADDR A:0x1e2862c
y.create.l HWIO_APPS_SMMU_CB9_TLBIVAAL_HIGH_APPS_ADDR A:0x1e2962c
y.create.l HWIO_APPS_SMMU_CB10_TLBIVAAL_HIGH_APPS_ADDR A:0x1e2a62c
y.create.l HWIO_APPS_SMMU_CB11_TLBIVAAL_HIGH_APPS_ADDR A:0x1e2b62c
y.create.l HWIO_APPS_SMMU_CB12_TLBIVAAL_HIGH_APPS_ADDR A:0x1e2c62c
y.create.l HWIO_APPS_SMMU_CB13_TLBIVAAL_HIGH_APPS_ADDR A:0x1e2d62c
y.create.l HWIO_APPS_SMMU_CB14_TLBIVAAL_HIGH_APPS_ADDR A:0x1e2e62c
y.create.l HWIO_APPS_SMMU_CB15_TLBIVAAL_HIGH_APPS_ADDR A:0x1e2f62c
y.create.l HWIO_APPS_SMMU_CB16_TLBIVAAL_HIGH_APPS_ADDR A:0x1e3062c
y.create.l HWIO_APPS_SMMU_CB17_TLBIVAAL_HIGH_APPS_ADDR A:0x1e3162c
y.create.l HWIO_APPS_SMMU_CB18_TLBIVAAL_HIGH_APPS_ADDR A:0x1e3262c
y.create.l HWIO_APPS_SMMU_CB19_TLBIVAAL_HIGH_APPS_ADDR A:0x1e3362c
y.create.l HWIO_APPS_SMMU_CB20_TLBIVAAL_HIGH_APPS_ADDR A:0x1e3462c
y.create.l HWIO_APPS_SMMU_CB21_TLBIVAAL_HIGH_APPS_ADDR A:0x1e3562c
y.create.l HWIO_APPS_SMMU_CB22_TLBIVAAL_HIGH_APPS_ADDR A:0x1e3662c
y.create.l HWIO_APPS_SMMU_CB23_TLBIVAAL_HIGH_APPS_ADDR A:0x1e3762c
y.create.l HWIO_APPS_SMMU_CB24_TLBIVAAL_HIGH_APPS_ADDR A:0x1e3862c
y.create.l HWIO_APPS_SMMU_CB25_TLBIVAAL_HIGH_APPS_ADDR A:0x1e3962c
y.create.l HWIO_APPS_SMMU_CB26_TLBIVAAL_HIGH_APPS_ADDR A:0x1e3a62c
y.create.l HWIO_APPS_SMMU_CB27_TLBIVAAL_HIGH_APPS_ADDR A:0x1e3b62c
y.create.l HWIO_APPS_SMMU_CB28_TLBIVAAL_HIGH_APPS_ADDR A:0x1e3c62c
y.create.l HWIO_APPS_SMMU_CB29_TLBIVAAL_HIGH_APPS_ADDR A:0x1e3d62c
y.create.l HWIO_APPS_SMMU_CB30_TLBIVAAL_HIGH_APPS_ADDR A:0x1e3e62c
y.create.l HWIO_APPS_SMMU_CB31_TLBIVAAL_HIGH_APPS_ADDR A:0x1e3f62c
y.create.l HWIO_APPS_SMMU_CB0_TLBIIPAS2_LOW_APPS_ADDR A:0x1e20630
y.create.l HWIO_APPS_SMMU_CB1_TLBIIPAS2_LOW_APPS_ADDR A:0x1e21630
y.create.l HWIO_APPS_SMMU_CB2_TLBIIPAS2_LOW_APPS_ADDR A:0x1e22630
y.create.l HWIO_APPS_SMMU_CB3_TLBIIPAS2_LOW_APPS_ADDR A:0x1e23630
y.create.l HWIO_APPS_SMMU_CB4_TLBIIPAS2_LOW_APPS_ADDR A:0x1e24630
y.create.l HWIO_APPS_SMMU_CB5_TLBIIPAS2_LOW_APPS_ADDR A:0x1e25630
y.create.l HWIO_APPS_SMMU_CB6_TLBIIPAS2_LOW_APPS_ADDR A:0x1e26630
y.create.l HWIO_APPS_SMMU_CB7_TLBIIPAS2_LOW_APPS_ADDR A:0x1e27630
y.create.l HWIO_APPS_SMMU_CB8_TLBIIPAS2_LOW_APPS_ADDR A:0x1e28630
y.create.l HWIO_APPS_SMMU_CB9_TLBIIPAS2_LOW_APPS_ADDR A:0x1e29630
y.create.l HWIO_APPS_SMMU_CB10_TLBIIPAS2_LOW_APPS_ADDR A:0x1e2a630
y.create.l HWIO_APPS_SMMU_CB11_TLBIIPAS2_LOW_APPS_ADDR A:0x1e2b630
y.create.l HWIO_APPS_SMMU_CB12_TLBIIPAS2_LOW_APPS_ADDR A:0x1e2c630
y.create.l HWIO_APPS_SMMU_CB13_TLBIIPAS2_LOW_APPS_ADDR A:0x1e2d630
y.create.l HWIO_APPS_SMMU_CB14_TLBIIPAS2_LOW_APPS_ADDR A:0x1e2e630
y.create.l HWIO_APPS_SMMU_CB15_TLBIIPAS2_LOW_APPS_ADDR A:0x1e2f630
y.create.l HWIO_APPS_SMMU_CB16_TLBIIPAS2_LOW_APPS_ADDR A:0x1e30630
y.create.l HWIO_APPS_SMMU_CB17_TLBIIPAS2_LOW_APPS_ADDR A:0x1e31630
y.create.l HWIO_APPS_SMMU_CB18_TLBIIPAS2_LOW_APPS_ADDR A:0x1e32630
y.create.l HWIO_APPS_SMMU_CB19_TLBIIPAS2_LOW_APPS_ADDR A:0x1e33630
y.create.l HWIO_APPS_SMMU_CB20_TLBIIPAS2_LOW_APPS_ADDR A:0x1e34630
y.create.l HWIO_APPS_SMMU_CB21_TLBIIPAS2_LOW_APPS_ADDR A:0x1e35630
y.create.l HWIO_APPS_SMMU_CB22_TLBIIPAS2_LOW_APPS_ADDR A:0x1e36630
y.create.l HWIO_APPS_SMMU_CB23_TLBIIPAS2_LOW_APPS_ADDR A:0x1e37630
y.create.l HWIO_APPS_SMMU_CB24_TLBIIPAS2_LOW_APPS_ADDR A:0x1e38630
y.create.l HWIO_APPS_SMMU_CB25_TLBIIPAS2_LOW_APPS_ADDR A:0x1e39630
y.create.l HWIO_APPS_SMMU_CB26_TLBIIPAS2_LOW_APPS_ADDR A:0x1e3a630
y.create.l HWIO_APPS_SMMU_CB27_TLBIIPAS2_LOW_APPS_ADDR A:0x1e3b630
y.create.l HWIO_APPS_SMMU_CB28_TLBIIPAS2_LOW_APPS_ADDR A:0x1e3c630
y.create.l HWIO_APPS_SMMU_CB29_TLBIIPAS2_LOW_APPS_ADDR A:0x1e3d630
y.create.l HWIO_APPS_SMMU_CB30_TLBIIPAS2_LOW_APPS_ADDR A:0x1e3e630
y.create.l HWIO_APPS_SMMU_CB31_TLBIIPAS2_LOW_APPS_ADDR A:0x1e3f630
y.create.l HWIO_APPS_SMMU_CB0_TLBIIPAS2_HIGH_APPS_ADDR A:0x1e20634
y.create.l HWIO_APPS_SMMU_CB1_TLBIIPAS2_HIGH_APPS_ADDR A:0x1e21634
y.create.l HWIO_APPS_SMMU_CB2_TLBIIPAS2_HIGH_APPS_ADDR A:0x1e22634
y.create.l HWIO_APPS_SMMU_CB3_TLBIIPAS2_HIGH_APPS_ADDR A:0x1e23634
y.create.l HWIO_APPS_SMMU_CB4_TLBIIPAS2_HIGH_APPS_ADDR A:0x1e24634
y.create.l HWIO_APPS_SMMU_CB5_TLBIIPAS2_HIGH_APPS_ADDR A:0x1e25634
y.create.l HWIO_APPS_SMMU_CB6_TLBIIPAS2_HIGH_APPS_ADDR A:0x1e26634
y.create.l HWIO_APPS_SMMU_CB7_TLBIIPAS2_HIGH_APPS_ADDR A:0x1e27634
y.create.l HWIO_APPS_SMMU_CB8_TLBIIPAS2_HIGH_APPS_ADDR A:0x1e28634
y.create.l HWIO_APPS_SMMU_CB9_TLBIIPAS2_HIGH_APPS_ADDR A:0x1e29634
y.create.l HWIO_APPS_SMMU_CB10_TLBIIPAS2_HIGH_APPS_ADDR A:0x1e2a634
y.create.l HWIO_APPS_SMMU_CB11_TLBIIPAS2_HIGH_APPS_ADDR A:0x1e2b634
y.create.l HWIO_APPS_SMMU_CB12_TLBIIPAS2_HIGH_APPS_ADDR A:0x1e2c634
y.create.l HWIO_APPS_SMMU_CB13_TLBIIPAS2_HIGH_APPS_ADDR A:0x1e2d634
y.create.l HWIO_APPS_SMMU_CB14_TLBIIPAS2_HIGH_APPS_ADDR A:0x1e2e634
y.create.l HWIO_APPS_SMMU_CB15_TLBIIPAS2_HIGH_APPS_ADDR A:0x1e2f634
y.create.l HWIO_APPS_SMMU_CB16_TLBIIPAS2_HIGH_APPS_ADDR A:0x1e30634
y.create.l HWIO_APPS_SMMU_CB17_TLBIIPAS2_HIGH_APPS_ADDR A:0x1e31634
y.create.l HWIO_APPS_SMMU_CB18_TLBIIPAS2_HIGH_APPS_ADDR A:0x1e32634
y.create.l HWIO_APPS_SMMU_CB19_TLBIIPAS2_HIGH_APPS_ADDR A:0x1e33634
y.create.l HWIO_APPS_SMMU_CB20_TLBIIPAS2_HIGH_APPS_ADDR A:0x1e34634
y.create.l HWIO_APPS_SMMU_CB21_TLBIIPAS2_HIGH_APPS_ADDR A:0x1e35634
y.create.l HWIO_APPS_SMMU_CB22_TLBIIPAS2_HIGH_APPS_ADDR A:0x1e36634
y.create.l HWIO_APPS_SMMU_CB23_TLBIIPAS2_HIGH_APPS_ADDR A:0x1e37634
y.create.l HWIO_APPS_SMMU_CB24_TLBIIPAS2_HIGH_APPS_ADDR A:0x1e38634
y.create.l HWIO_APPS_SMMU_CB25_TLBIIPAS2_HIGH_APPS_ADDR A:0x1e39634
y.create.l HWIO_APPS_SMMU_CB26_TLBIIPAS2_HIGH_APPS_ADDR A:0x1e3a634
y.create.l HWIO_APPS_SMMU_CB27_TLBIIPAS2_HIGH_APPS_ADDR A:0x1e3b634
y.create.l HWIO_APPS_SMMU_CB28_TLBIIPAS2_HIGH_APPS_ADDR A:0x1e3c634
y.create.l HWIO_APPS_SMMU_CB29_TLBIIPAS2_HIGH_APPS_ADDR A:0x1e3d634
y.create.l HWIO_APPS_SMMU_CB30_TLBIIPAS2_HIGH_APPS_ADDR A:0x1e3e634
y.create.l HWIO_APPS_SMMU_CB31_TLBIIPAS2_HIGH_APPS_ADDR A:0x1e3f634
y.create.l HWIO_APPS_SMMU_CB0_TLBIIPAS2L_LOW_APPS_ADDR A:0x1e20638
y.create.l HWIO_APPS_SMMU_CB1_TLBIIPAS2L_LOW_APPS_ADDR A:0x1e21638
y.create.l HWIO_APPS_SMMU_CB2_TLBIIPAS2L_LOW_APPS_ADDR A:0x1e22638
y.create.l HWIO_APPS_SMMU_CB3_TLBIIPAS2L_LOW_APPS_ADDR A:0x1e23638
y.create.l HWIO_APPS_SMMU_CB4_TLBIIPAS2L_LOW_APPS_ADDR A:0x1e24638
y.create.l HWIO_APPS_SMMU_CB5_TLBIIPAS2L_LOW_APPS_ADDR A:0x1e25638
y.create.l HWIO_APPS_SMMU_CB6_TLBIIPAS2L_LOW_APPS_ADDR A:0x1e26638
y.create.l HWIO_APPS_SMMU_CB7_TLBIIPAS2L_LOW_APPS_ADDR A:0x1e27638
y.create.l HWIO_APPS_SMMU_CB8_TLBIIPAS2L_LOW_APPS_ADDR A:0x1e28638
y.create.l HWIO_APPS_SMMU_CB9_TLBIIPAS2L_LOW_APPS_ADDR A:0x1e29638
y.create.l HWIO_APPS_SMMU_CB10_TLBIIPAS2L_LOW_APPS_ADDR A:0x1e2a638
y.create.l HWIO_APPS_SMMU_CB11_TLBIIPAS2L_LOW_APPS_ADDR A:0x1e2b638
y.create.l HWIO_APPS_SMMU_CB12_TLBIIPAS2L_LOW_APPS_ADDR A:0x1e2c638
y.create.l HWIO_APPS_SMMU_CB13_TLBIIPAS2L_LOW_APPS_ADDR A:0x1e2d638
y.create.l HWIO_APPS_SMMU_CB14_TLBIIPAS2L_LOW_APPS_ADDR A:0x1e2e638
y.create.l HWIO_APPS_SMMU_CB15_TLBIIPAS2L_LOW_APPS_ADDR A:0x1e2f638
y.create.l HWIO_APPS_SMMU_CB16_TLBIIPAS2L_LOW_APPS_ADDR A:0x1e30638
y.create.l HWIO_APPS_SMMU_CB17_TLBIIPAS2L_LOW_APPS_ADDR A:0x1e31638
y.create.l HWIO_APPS_SMMU_CB18_TLBIIPAS2L_LOW_APPS_ADDR A:0x1e32638
y.create.l HWIO_APPS_SMMU_CB19_TLBIIPAS2L_LOW_APPS_ADDR A:0x1e33638
y.create.l HWIO_APPS_SMMU_CB20_TLBIIPAS2L_LOW_APPS_ADDR A:0x1e34638
y.create.l HWIO_APPS_SMMU_CB21_TLBIIPAS2L_LOW_APPS_ADDR A:0x1e35638
y.create.l HWIO_APPS_SMMU_CB22_TLBIIPAS2L_LOW_APPS_ADDR A:0x1e36638
y.create.l HWIO_APPS_SMMU_CB23_TLBIIPAS2L_LOW_APPS_ADDR A:0x1e37638
y.create.l HWIO_APPS_SMMU_CB24_TLBIIPAS2L_LOW_APPS_ADDR A:0x1e38638
y.create.l HWIO_APPS_SMMU_CB25_TLBIIPAS2L_LOW_APPS_ADDR A:0x1e39638
y.create.l HWIO_APPS_SMMU_CB26_TLBIIPAS2L_LOW_APPS_ADDR A:0x1e3a638
y.create.l HWIO_APPS_SMMU_CB27_TLBIIPAS2L_LOW_APPS_ADDR A:0x1e3b638
y.create.l HWIO_APPS_SMMU_CB28_TLBIIPAS2L_LOW_APPS_ADDR A:0x1e3c638
y.create.l HWIO_APPS_SMMU_CB29_TLBIIPAS2L_LOW_APPS_ADDR A:0x1e3d638
y.create.l HWIO_APPS_SMMU_CB30_TLBIIPAS2L_LOW_APPS_ADDR A:0x1e3e638
y.create.l HWIO_APPS_SMMU_CB31_TLBIIPAS2L_LOW_APPS_ADDR A:0x1e3f638
y.create.l HWIO_APPS_SMMU_CB0_TLBIIPAS2L_HIGH_APPS_ADDR A:0x1e2063c
y.create.l HWIO_APPS_SMMU_CB1_TLBIIPAS2L_HIGH_APPS_ADDR A:0x1e2163c
y.create.l HWIO_APPS_SMMU_CB2_TLBIIPAS2L_HIGH_APPS_ADDR A:0x1e2263c
y.create.l HWIO_APPS_SMMU_CB3_TLBIIPAS2L_HIGH_APPS_ADDR A:0x1e2363c
y.create.l HWIO_APPS_SMMU_CB4_TLBIIPAS2L_HIGH_APPS_ADDR A:0x1e2463c
y.create.l HWIO_APPS_SMMU_CB5_TLBIIPAS2L_HIGH_APPS_ADDR A:0x1e2563c
y.create.l HWIO_APPS_SMMU_CB6_TLBIIPAS2L_HIGH_APPS_ADDR A:0x1e2663c
y.create.l HWIO_APPS_SMMU_CB7_TLBIIPAS2L_HIGH_APPS_ADDR A:0x1e2763c
y.create.l HWIO_APPS_SMMU_CB8_TLBIIPAS2L_HIGH_APPS_ADDR A:0x1e2863c
y.create.l HWIO_APPS_SMMU_CB9_TLBIIPAS2L_HIGH_APPS_ADDR A:0x1e2963c
y.create.l HWIO_APPS_SMMU_CB10_TLBIIPAS2L_HIGH_APPS_ADDR A:0x1e2a63c
y.create.l HWIO_APPS_SMMU_CB11_TLBIIPAS2L_HIGH_APPS_ADDR A:0x1e2b63c
y.create.l HWIO_APPS_SMMU_CB12_TLBIIPAS2L_HIGH_APPS_ADDR A:0x1e2c63c
y.create.l HWIO_APPS_SMMU_CB13_TLBIIPAS2L_HIGH_APPS_ADDR A:0x1e2d63c
y.create.l HWIO_APPS_SMMU_CB14_TLBIIPAS2L_HIGH_APPS_ADDR A:0x1e2e63c
y.create.l HWIO_APPS_SMMU_CB15_TLBIIPAS2L_HIGH_APPS_ADDR A:0x1e2f63c
y.create.l HWIO_APPS_SMMU_CB16_TLBIIPAS2L_HIGH_APPS_ADDR A:0x1e3063c
y.create.l HWIO_APPS_SMMU_CB17_TLBIIPAS2L_HIGH_APPS_ADDR A:0x1e3163c
y.create.l HWIO_APPS_SMMU_CB18_TLBIIPAS2L_HIGH_APPS_ADDR A:0x1e3263c
y.create.l HWIO_APPS_SMMU_CB19_TLBIIPAS2L_HIGH_APPS_ADDR A:0x1e3363c
y.create.l HWIO_APPS_SMMU_CB20_TLBIIPAS2L_HIGH_APPS_ADDR A:0x1e3463c
y.create.l HWIO_APPS_SMMU_CB21_TLBIIPAS2L_HIGH_APPS_ADDR A:0x1e3563c
y.create.l HWIO_APPS_SMMU_CB22_TLBIIPAS2L_HIGH_APPS_ADDR A:0x1e3663c
y.create.l HWIO_APPS_SMMU_CB23_TLBIIPAS2L_HIGH_APPS_ADDR A:0x1e3763c
y.create.l HWIO_APPS_SMMU_CB24_TLBIIPAS2L_HIGH_APPS_ADDR A:0x1e3863c
y.create.l HWIO_APPS_SMMU_CB25_TLBIIPAS2L_HIGH_APPS_ADDR A:0x1e3963c
y.create.l HWIO_APPS_SMMU_CB26_TLBIIPAS2L_HIGH_APPS_ADDR A:0x1e3a63c
y.create.l HWIO_APPS_SMMU_CB27_TLBIIPAS2L_HIGH_APPS_ADDR A:0x1e3b63c
y.create.l HWIO_APPS_SMMU_CB28_TLBIIPAS2L_HIGH_APPS_ADDR A:0x1e3c63c
y.create.l HWIO_APPS_SMMU_CB29_TLBIIPAS2L_HIGH_APPS_ADDR A:0x1e3d63c
y.create.l HWIO_APPS_SMMU_CB30_TLBIIPAS2L_HIGH_APPS_ADDR A:0x1e3e63c
y.create.l HWIO_APPS_SMMU_CB31_TLBIIPAS2L_HIGH_APPS_ADDR A:0x1e3f63c
y.create.l HWIO_APPS_SMMU_CB0_TLBSYNC_APPS_ADDR A:0x1e207f0
y.create.l HWIO_APPS_SMMU_CB1_TLBSYNC_APPS_ADDR A:0x1e217f0
y.create.l HWIO_APPS_SMMU_CB2_TLBSYNC_APPS_ADDR A:0x1e227f0
y.create.l HWIO_APPS_SMMU_CB3_TLBSYNC_APPS_ADDR A:0x1e237f0
y.create.l HWIO_APPS_SMMU_CB4_TLBSYNC_APPS_ADDR A:0x1e247f0
y.create.l HWIO_APPS_SMMU_CB5_TLBSYNC_APPS_ADDR A:0x1e257f0
y.create.l HWIO_APPS_SMMU_CB6_TLBSYNC_APPS_ADDR A:0x1e267f0
y.create.l HWIO_APPS_SMMU_CB7_TLBSYNC_APPS_ADDR A:0x1e277f0
y.create.l HWIO_APPS_SMMU_CB8_TLBSYNC_APPS_ADDR A:0x1e287f0
y.create.l HWIO_APPS_SMMU_CB9_TLBSYNC_APPS_ADDR A:0x1e297f0
y.create.l HWIO_APPS_SMMU_CB10_TLBSYNC_APPS_ADDR A:0x1e2a7f0
y.create.l HWIO_APPS_SMMU_CB11_TLBSYNC_APPS_ADDR A:0x1e2b7f0
y.create.l HWIO_APPS_SMMU_CB12_TLBSYNC_APPS_ADDR A:0x1e2c7f0
y.create.l HWIO_APPS_SMMU_CB13_TLBSYNC_APPS_ADDR A:0x1e2d7f0
y.create.l HWIO_APPS_SMMU_CB14_TLBSYNC_APPS_ADDR A:0x1e2e7f0
y.create.l HWIO_APPS_SMMU_CB15_TLBSYNC_APPS_ADDR A:0x1e2f7f0
y.create.l HWIO_APPS_SMMU_CB16_TLBSYNC_APPS_ADDR A:0x1e307f0
y.create.l HWIO_APPS_SMMU_CB17_TLBSYNC_APPS_ADDR A:0x1e317f0
y.create.l HWIO_APPS_SMMU_CB18_TLBSYNC_APPS_ADDR A:0x1e327f0
y.create.l HWIO_APPS_SMMU_CB19_TLBSYNC_APPS_ADDR A:0x1e337f0
y.create.l HWIO_APPS_SMMU_CB20_TLBSYNC_APPS_ADDR A:0x1e347f0
y.create.l HWIO_APPS_SMMU_CB21_TLBSYNC_APPS_ADDR A:0x1e357f0
y.create.l HWIO_APPS_SMMU_CB22_TLBSYNC_APPS_ADDR A:0x1e367f0
y.create.l HWIO_APPS_SMMU_CB23_TLBSYNC_APPS_ADDR A:0x1e377f0
y.create.l HWIO_APPS_SMMU_CB24_TLBSYNC_APPS_ADDR A:0x1e387f0
y.create.l HWIO_APPS_SMMU_CB25_TLBSYNC_APPS_ADDR A:0x1e397f0
y.create.l HWIO_APPS_SMMU_CB26_TLBSYNC_APPS_ADDR A:0x1e3a7f0
y.create.l HWIO_APPS_SMMU_CB27_TLBSYNC_APPS_ADDR A:0x1e3b7f0
y.create.l HWIO_APPS_SMMU_CB28_TLBSYNC_APPS_ADDR A:0x1e3c7f0
y.create.l HWIO_APPS_SMMU_CB29_TLBSYNC_APPS_ADDR A:0x1e3d7f0
y.create.l HWIO_APPS_SMMU_CB30_TLBSYNC_APPS_ADDR A:0x1e3e7f0
y.create.l HWIO_APPS_SMMU_CB31_TLBSYNC_APPS_ADDR A:0x1e3f7f0
y.create.l HWIO_APPS_SMMU_CB0_TLBSTATUS_APPS_ADDR A:0x1e207f4
y.create.l HWIO_APPS_SMMU_CB1_TLBSTATUS_APPS_ADDR A:0x1e217f4
y.create.l HWIO_APPS_SMMU_CB2_TLBSTATUS_APPS_ADDR A:0x1e227f4
y.create.l HWIO_APPS_SMMU_CB3_TLBSTATUS_APPS_ADDR A:0x1e237f4
y.create.l HWIO_APPS_SMMU_CB4_TLBSTATUS_APPS_ADDR A:0x1e247f4
y.create.l HWIO_APPS_SMMU_CB5_TLBSTATUS_APPS_ADDR A:0x1e257f4
y.create.l HWIO_APPS_SMMU_CB6_TLBSTATUS_APPS_ADDR A:0x1e267f4
y.create.l HWIO_APPS_SMMU_CB7_TLBSTATUS_APPS_ADDR A:0x1e277f4
y.create.l HWIO_APPS_SMMU_CB8_TLBSTATUS_APPS_ADDR A:0x1e287f4
y.create.l HWIO_APPS_SMMU_CB9_TLBSTATUS_APPS_ADDR A:0x1e297f4
y.create.l HWIO_APPS_SMMU_CB10_TLBSTATUS_APPS_ADDR A:0x1e2a7f4
y.create.l HWIO_APPS_SMMU_CB11_TLBSTATUS_APPS_ADDR A:0x1e2b7f4
y.create.l HWIO_APPS_SMMU_CB12_TLBSTATUS_APPS_ADDR A:0x1e2c7f4
y.create.l HWIO_APPS_SMMU_CB13_TLBSTATUS_APPS_ADDR A:0x1e2d7f4
y.create.l HWIO_APPS_SMMU_CB14_TLBSTATUS_APPS_ADDR A:0x1e2e7f4
y.create.l HWIO_APPS_SMMU_CB15_TLBSTATUS_APPS_ADDR A:0x1e2f7f4
y.create.l HWIO_APPS_SMMU_CB16_TLBSTATUS_APPS_ADDR A:0x1e307f4
y.create.l HWIO_APPS_SMMU_CB17_TLBSTATUS_APPS_ADDR A:0x1e317f4
y.create.l HWIO_APPS_SMMU_CB18_TLBSTATUS_APPS_ADDR A:0x1e327f4
y.create.l HWIO_APPS_SMMU_CB19_TLBSTATUS_APPS_ADDR A:0x1e337f4
y.create.l HWIO_APPS_SMMU_CB20_TLBSTATUS_APPS_ADDR A:0x1e347f4
y.create.l HWIO_APPS_SMMU_CB21_TLBSTATUS_APPS_ADDR A:0x1e357f4
y.create.l HWIO_APPS_SMMU_CB22_TLBSTATUS_APPS_ADDR A:0x1e367f4
y.create.l HWIO_APPS_SMMU_CB23_TLBSTATUS_APPS_ADDR A:0x1e377f4
y.create.l HWIO_APPS_SMMU_CB24_TLBSTATUS_APPS_ADDR A:0x1e387f4
y.create.l HWIO_APPS_SMMU_CB25_TLBSTATUS_APPS_ADDR A:0x1e397f4
y.create.l HWIO_APPS_SMMU_CB26_TLBSTATUS_APPS_ADDR A:0x1e3a7f4
y.create.l HWIO_APPS_SMMU_CB27_TLBSTATUS_APPS_ADDR A:0x1e3b7f4
y.create.l HWIO_APPS_SMMU_CB28_TLBSTATUS_APPS_ADDR A:0x1e3c7f4
y.create.l HWIO_APPS_SMMU_CB29_TLBSTATUS_APPS_ADDR A:0x1e3d7f4
y.create.l HWIO_APPS_SMMU_CB30_TLBSTATUS_APPS_ADDR A:0x1e3e7f4
y.create.l HWIO_APPS_SMMU_CB31_TLBSTATUS_APPS_ADDR A:0x1e3f7f4
y.create.l HWIO_APPS_SMMU_CB0_PMEVCNTR0_APPS_ADDR A:0x1e20e00
y.create.l HWIO_APPS_SMMU_CB1_PMEVCNTR0_APPS_ADDR A:0x1e21e00
y.create.l HWIO_APPS_SMMU_CB2_PMEVCNTR0_APPS_ADDR A:0x1e22e00
y.create.l HWIO_APPS_SMMU_CB3_PMEVCNTR0_APPS_ADDR A:0x1e23e00
y.create.l HWIO_APPS_SMMU_CB4_PMEVCNTR0_APPS_ADDR A:0x1e24e00
y.create.l HWIO_APPS_SMMU_CB5_PMEVCNTR0_APPS_ADDR A:0x1e25e00
y.create.l HWIO_APPS_SMMU_CB6_PMEVCNTR0_APPS_ADDR A:0x1e26e00
y.create.l HWIO_APPS_SMMU_CB7_PMEVCNTR0_APPS_ADDR A:0x1e27e00
y.create.l HWIO_APPS_SMMU_CB8_PMEVCNTR0_APPS_ADDR A:0x1e28e00
y.create.l HWIO_APPS_SMMU_CB9_PMEVCNTR0_APPS_ADDR A:0x1e29e00
y.create.l HWIO_APPS_SMMU_CB10_PMEVCNTR0_APPS_ADDR A:0x1e2ae00
y.create.l HWIO_APPS_SMMU_CB11_PMEVCNTR0_APPS_ADDR A:0x1e2be00
y.create.l HWIO_APPS_SMMU_CB12_PMEVCNTR0_APPS_ADDR A:0x1e2ce00
y.create.l HWIO_APPS_SMMU_CB13_PMEVCNTR0_APPS_ADDR A:0x1e2de00
y.create.l HWIO_APPS_SMMU_CB14_PMEVCNTR0_APPS_ADDR A:0x1e2ee00
y.create.l HWIO_APPS_SMMU_CB15_PMEVCNTR0_APPS_ADDR A:0x1e2fe00
y.create.l HWIO_APPS_SMMU_CB16_PMEVCNTR0_APPS_ADDR A:0x1e30e00
y.create.l HWIO_APPS_SMMU_CB17_PMEVCNTR0_APPS_ADDR A:0x1e31e00
y.create.l HWIO_APPS_SMMU_CB18_PMEVCNTR0_APPS_ADDR A:0x1e32e00
y.create.l HWIO_APPS_SMMU_CB19_PMEVCNTR0_APPS_ADDR A:0x1e33e00
y.create.l HWIO_APPS_SMMU_CB20_PMEVCNTR0_APPS_ADDR A:0x1e34e00
y.create.l HWIO_APPS_SMMU_CB21_PMEVCNTR0_APPS_ADDR A:0x1e35e00
y.create.l HWIO_APPS_SMMU_CB22_PMEVCNTR0_APPS_ADDR A:0x1e36e00
y.create.l HWIO_APPS_SMMU_CB23_PMEVCNTR0_APPS_ADDR A:0x1e37e00
y.create.l HWIO_APPS_SMMU_CB24_PMEVCNTR0_APPS_ADDR A:0x1e38e00
y.create.l HWIO_APPS_SMMU_CB25_PMEVCNTR0_APPS_ADDR A:0x1e39e00
y.create.l HWIO_APPS_SMMU_CB26_PMEVCNTR0_APPS_ADDR A:0x1e3ae00
y.create.l HWIO_APPS_SMMU_CB27_PMEVCNTR0_APPS_ADDR A:0x1e3be00
y.create.l HWIO_APPS_SMMU_CB28_PMEVCNTR0_APPS_ADDR A:0x1e3ce00
y.create.l HWIO_APPS_SMMU_CB29_PMEVCNTR0_APPS_ADDR A:0x1e3de00
y.create.l HWIO_APPS_SMMU_CB30_PMEVCNTR0_APPS_ADDR A:0x1e3ee00
y.create.l HWIO_APPS_SMMU_CB31_PMEVCNTR0_APPS_ADDR A:0x1e3fe00
y.create.l HWIO_APPS_SMMU_CB0_PMEVCNTR1_APPS_ADDR A:0x1e20e04
y.create.l HWIO_APPS_SMMU_CB1_PMEVCNTR1_APPS_ADDR A:0x1e21e04
y.create.l HWIO_APPS_SMMU_CB2_PMEVCNTR1_APPS_ADDR A:0x1e22e04
y.create.l HWIO_APPS_SMMU_CB3_PMEVCNTR1_APPS_ADDR A:0x1e23e04
y.create.l HWIO_APPS_SMMU_CB4_PMEVCNTR1_APPS_ADDR A:0x1e24e04
y.create.l HWIO_APPS_SMMU_CB5_PMEVCNTR1_APPS_ADDR A:0x1e25e04
y.create.l HWIO_APPS_SMMU_CB6_PMEVCNTR1_APPS_ADDR A:0x1e26e04
y.create.l HWIO_APPS_SMMU_CB7_PMEVCNTR1_APPS_ADDR A:0x1e27e04
y.create.l HWIO_APPS_SMMU_CB8_PMEVCNTR1_APPS_ADDR A:0x1e28e04
y.create.l HWIO_APPS_SMMU_CB9_PMEVCNTR1_APPS_ADDR A:0x1e29e04
y.create.l HWIO_APPS_SMMU_CB10_PMEVCNTR1_APPS_ADDR A:0x1e2ae04
y.create.l HWIO_APPS_SMMU_CB11_PMEVCNTR1_APPS_ADDR A:0x1e2be04
y.create.l HWIO_APPS_SMMU_CB12_PMEVCNTR1_APPS_ADDR A:0x1e2ce04
y.create.l HWIO_APPS_SMMU_CB13_PMEVCNTR1_APPS_ADDR A:0x1e2de04
y.create.l HWIO_APPS_SMMU_CB14_PMEVCNTR1_APPS_ADDR A:0x1e2ee04
y.create.l HWIO_APPS_SMMU_CB15_PMEVCNTR1_APPS_ADDR A:0x1e2fe04
y.create.l HWIO_APPS_SMMU_CB16_PMEVCNTR1_APPS_ADDR A:0x1e30e04
y.create.l HWIO_APPS_SMMU_CB17_PMEVCNTR1_APPS_ADDR A:0x1e31e04
y.create.l HWIO_APPS_SMMU_CB18_PMEVCNTR1_APPS_ADDR A:0x1e32e04
y.create.l HWIO_APPS_SMMU_CB19_PMEVCNTR1_APPS_ADDR A:0x1e33e04
y.create.l HWIO_APPS_SMMU_CB20_PMEVCNTR1_APPS_ADDR A:0x1e34e04
y.create.l HWIO_APPS_SMMU_CB21_PMEVCNTR1_APPS_ADDR A:0x1e35e04
y.create.l HWIO_APPS_SMMU_CB22_PMEVCNTR1_APPS_ADDR A:0x1e36e04
y.create.l HWIO_APPS_SMMU_CB23_PMEVCNTR1_APPS_ADDR A:0x1e37e04
y.create.l HWIO_APPS_SMMU_CB24_PMEVCNTR1_APPS_ADDR A:0x1e38e04
y.create.l HWIO_APPS_SMMU_CB25_PMEVCNTR1_APPS_ADDR A:0x1e39e04
y.create.l HWIO_APPS_SMMU_CB26_PMEVCNTR1_APPS_ADDR A:0x1e3ae04
y.create.l HWIO_APPS_SMMU_CB27_PMEVCNTR1_APPS_ADDR A:0x1e3be04
y.create.l HWIO_APPS_SMMU_CB28_PMEVCNTR1_APPS_ADDR A:0x1e3ce04
y.create.l HWIO_APPS_SMMU_CB29_PMEVCNTR1_APPS_ADDR A:0x1e3de04
y.create.l HWIO_APPS_SMMU_CB30_PMEVCNTR1_APPS_ADDR A:0x1e3ee04
y.create.l HWIO_APPS_SMMU_CB31_PMEVCNTR1_APPS_ADDR A:0x1e3fe04
y.create.l HWIO_APPS_SMMU_CB0_PMEVCNTR2_APPS_ADDR A:0x1e20e08
y.create.l HWIO_APPS_SMMU_CB1_PMEVCNTR2_APPS_ADDR A:0x1e21e08
y.create.l HWIO_APPS_SMMU_CB2_PMEVCNTR2_APPS_ADDR A:0x1e22e08
y.create.l HWIO_APPS_SMMU_CB3_PMEVCNTR2_APPS_ADDR A:0x1e23e08
y.create.l HWIO_APPS_SMMU_CB4_PMEVCNTR2_APPS_ADDR A:0x1e24e08
y.create.l HWIO_APPS_SMMU_CB5_PMEVCNTR2_APPS_ADDR A:0x1e25e08
y.create.l HWIO_APPS_SMMU_CB6_PMEVCNTR2_APPS_ADDR A:0x1e26e08
y.create.l HWIO_APPS_SMMU_CB7_PMEVCNTR2_APPS_ADDR A:0x1e27e08
y.create.l HWIO_APPS_SMMU_CB8_PMEVCNTR2_APPS_ADDR A:0x1e28e08
y.create.l HWIO_APPS_SMMU_CB9_PMEVCNTR2_APPS_ADDR A:0x1e29e08
y.create.l HWIO_APPS_SMMU_CB10_PMEVCNTR2_APPS_ADDR A:0x1e2ae08
y.create.l HWIO_APPS_SMMU_CB11_PMEVCNTR2_APPS_ADDR A:0x1e2be08
y.create.l HWIO_APPS_SMMU_CB12_PMEVCNTR2_APPS_ADDR A:0x1e2ce08
y.create.l HWIO_APPS_SMMU_CB13_PMEVCNTR2_APPS_ADDR A:0x1e2de08
y.create.l HWIO_APPS_SMMU_CB14_PMEVCNTR2_APPS_ADDR A:0x1e2ee08
y.create.l HWIO_APPS_SMMU_CB15_PMEVCNTR2_APPS_ADDR A:0x1e2fe08
y.create.l HWIO_APPS_SMMU_CB16_PMEVCNTR2_APPS_ADDR A:0x1e30e08
y.create.l HWIO_APPS_SMMU_CB17_PMEVCNTR2_APPS_ADDR A:0x1e31e08
y.create.l HWIO_APPS_SMMU_CB18_PMEVCNTR2_APPS_ADDR A:0x1e32e08
y.create.l HWIO_APPS_SMMU_CB19_PMEVCNTR2_APPS_ADDR A:0x1e33e08
y.create.l HWIO_APPS_SMMU_CB20_PMEVCNTR2_APPS_ADDR A:0x1e34e08
y.create.l HWIO_APPS_SMMU_CB21_PMEVCNTR2_APPS_ADDR A:0x1e35e08
y.create.l HWIO_APPS_SMMU_CB22_PMEVCNTR2_APPS_ADDR A:0x1e36e08
y.create.l HWIO_APPS_SMMU_CB23_PMEVCNTR2_APPS_ADDR A:0x1e37e08
y.create.l HWIO_APPS_SMMU_CB24_PMEVCNTR2_APPS_ADDR A:0x1e38e08
y.create.l HWIO_APPS_SMMU_CB25_PMEVCNTR2_APPS_ADDR A:0x1e39e08
y.create.l HWIO_APPS_SMMU_CB26_PMEVCNTR2_APPS_ADDR A:0x1e3ae08
y.create.l HWIO_APPS_SMMU_CB27_PMEVCNTR2_APPS_ADDR A:0x1e3be08
y.create.l HWIO_APPS_SMMU_CB28_PMEVCNTR2_APPS_ADDR A:0x1e3ce08
y.create.l HWIO_APPS_SMMU_CB29_PMEVCNTR2_APPS_ADDR A:0x1e3de08
y.create.l HWIO_APPS_SMMU_CB30_PMEVCNTR2_APPS_ADDR A:0x1e3ee08
y.create.l HWIO_APPS_SMMU_CB31_PMEVCNTR2_APPS_ADDR A:0x1e3fe08
y.create.l HWIO_APPS_SMMU_CB0_PMEVCNTR3_APPS_ADDR A:0x1e20e0c
y.create.l HWIO_APPS_SMMU_CB1_PMEVCNTR3_APPS_ADDR A:0x1e21e0c
y.create.l HWIO_APPS_SMMU_CB2_PMEVCNTR3_APPS_ADDR A:0x1e22e0c
y.create.l HWIO_APPS_SMMU_CB3_PMEVCNTR3_APPS_ADDR A:0x1e23e0c
y.create.l HWIO_APPS_SMMU_CB4_PMEVCNTR3_APPS_ADDR A:0x1e24e0c
y.create.l HWIO_APPS_SMMU_CB5_PMEVCNTR3_APPS_ADDR A:0x1e25e0c
y.create.l HWIO_APPS_SMMU_CB6_PMEVCNTR3_APPS_ADDR A:0x1e26e0c
y.create.l HWIO_APPS_SMMU_CB7_PMEVCNTR3_APPS_ADDR A:0x1e27e0c
y.create.l HWIO_APPS_SMMU_CB8_PMEVCNTR3_APPS_ADDR A:0x1e28e0c
y.create.l HWIO_APPS_SMMU_CB9_PMEVCNTR3_APPS_ADDR A:0x1e29e0c
y.create.l HWIO_APPS_SMMU_CB10_PMEVCNTR3_APPS_ADDR A:0x1e2ae0c
y.create.l HWIO_APPS_SMMU_CB11_PMEVCNTR3_APPS_ADDR A:0x1e2be0c
y.create.l HWIO_APPS_SMMU_CB12_PMEVCNTR3_APPS_ADDR A:0x1e2ce0c
y.create.l HWIO_APPS_SMMU_CB13_PMEVCNTR3_APPS_ADDR A:0x1e2de0c
y.create.l HWIO_APPS_SMMU_CB14_PMEVCNTR3_APPS_ADDR A:0x1e2ee0c
y.create.l HWIO_APPS_SMMU_CB15_PMEVCNTR3_APPS_ADDR A:0x1e2fe0c
y.create.l HWIO_APPS_SMMU_CB16_PMEVCNTR3_APPS_ADDR A:0x1e30e0c
y.create.l HWIO_APPS_SMMU_CB17_PMEVCNTR3_APPS_ADDR A:0x1e31e0c
y.create.l HWIO_APPS_SMMU_CB18_PMEVCNTR3_APPS_ADDR A:0x1e32e0c
y.create.l HWIO_APPS_SMMU_CB19_PMEVCNTR3_APPS_ADDR A:0x1e33e0c
y.create.l HWIO_APPS_SMMU_CB20_PMEVCNTR3_APPS_ADDR A:0x1e34e0c
y.create.l HWIO_APPS_SMMU_CB21_PMEVCNTR3_APPS_ADDR A:0x1e35e0c
y.create.l HWIO_APPS_SMMU_CB22_PMEVCNTR3_APPS_ADDR A:0x1e36e0c
y.create.l HWIO_APPS_SMMU_CB23_PMEVCNTR3_APPS_ADDR A:0x1e37e0c
y.create.l HWIO_APPS_SMMU_CB24_PMEVCNTR3_APPS_ADDR A:0x1e38e0c
y.create.l HWIO_APPS_SMMU_CB25_PMEVCNTR3_APPS_ADDR A:0x1e39e0c
y.create.l HWIO_APPS_SMMU_CB26_PMEVCNTR3_APPS_ADDR A:0x1e3ae0c
y.create.l HWIO_APPS_SMMU_CB27_PMEVCNTR3_APPS_ADDR A:0x1e3be0c
y.create.l HWIO_APPS_SMMU_CB28_PMEVCNTR3_APPS_ADDR A:0x1e3ce0c
y.create.l HWIO_APPS_SMMU_CB29_PMEVCNTR3_APPS_ADDR A:0x1e3de0c
y.create.l HWIO_APPS_SMMU_CB30_PMEVCNTR3_APPS_ADDR A:0x1e3ee0c
y.create.l HWIO_APPS_SMMU_CB31_PMEVCNTR3_APPS_ADDR A:0x1e3fe0c
y.create.l HWIO_APPS_SMMU_CB0_PMEVTYPER0_APPS_ADDR A:0x1e20e80
y.create.l HWIO_APPS_SMMU_CB1_PMEVTYPER0_APPS_ADDR A:0x1e21e80
y.create.l HWIO_APPS_SMMU_CB2_PMEVTYPER0_APPS_ADDR A:0x1e22e80
y.create.l HWIO_APPS_SMMU_CB3_PMEVTYPER0_APPS_ADDR A:0x1e23e80
y.create.l HWIO_APPS_SMMU_CB4_PMEVTYPER0_APPS_ADDR A:0x1e24e80
y.create.l HWIO_APPS_SMMU_CB5_PMEVTYPER0_APPS_ADDR A:0x1e25e80
y.create.l HWIO_APPS_SMMU_CB6_PMEVTYPER0_APPS_ADDR A:0x1e26e80
y.create.l HWIO_APPS_SMMU_CB7_PMEVTYPER0_APPS_ADDR A:0x1e27e80
y.create.l HWIO_APPS_SMMU_CB8_PMEVTYPER0_APPS_ADDR A:0x1e28e80
y.create.l HWIO_APPS_SMMU_CB9_PMEVTYPER0_APPS_ADDR A:0x1e29e80
y.create.l HWIO_APPS_SMMU_CB10_PMEVTYPER0_APPS_ADDR A:0x1e2ae80
y.create.l HWIO_APPS_SMMU_CB11_PMEVTYPER0_APPS_ADDR A:0x1e2be80
y.create.l HWIO_APPS_SMMU_CB12_PMEVTYPER0_APPS_ADDR A:0x1e2ce80
y.create.l HWIO_APPS_SMMU_CB13_PMEVTYPER0_APPS_ADDR A:0x1e2de80
y.create.l HWIO_APPS_SMMU_CB14_PMEVTYPER0_APPS_ADDR A:0x1e2ee80
y.create.l HWIO_APPS_SMMU_CB15_PMEVTYPER0_APPS_ADDR A:0x1e2fe80
y.create.l HWIO_APPS_SMMU_CB16_PMEVTYPER0_APPS_ADDR A:0x1e30e80
y.create.l HWIO_APPS_SMMU_CB17_PMEVTYPER0_APPS_ADDR A:0x1e31e80
y.create.l HWIO_APPS_SMMU_CB18_PMEVTYPER0_APPS_ADDR A:0x1e32e80
y.create.l HWIO_APPS_SMMU_CB19_PMEVTYPER0_APPS_ADDR A:0x1e33e80
y.create.l HWIO_APPS_SMMU_CB20_PMEVTYPER0_APPS_ADDR A:0x1e34e80
y.create.l HWIO_APPS_SMMU_CB21_PMEVTYPER0_APPS_ADDR A:0x1e35e80
y.create.l HWIO_APPS_SMMU_CB22_PMEVTYPER0_APPS_ADDR A:0x1e36e80
y.create.l HWIO_APPS_SMMU_CB23_PMEVTYPER0_APPS_ADDR A:0x1e37e80
y.create.l HWIO_APPS_SMMU_CB24_PMEVTYPER0_APPS_ADDR A:0x1e38e80
y.create.l HWIO_APPS_SMMU_CB25_PMEVTYPER0_APPS_ADDR A:0x1e39e80
y.create.l HWIO_APPS_SMMU_CB26_PMEVTYPER0_APPS_ADDR A:0x1e3ae80
y.create.l HWIO_APPS_SMMU_CB27_PMEVTYPER0_APPS_ADDR A:0x1e3be80
y.create.l HWIO_APPS_SMMU_CB28_PMEVTYPER0_APPS_ADDR A:0x1e3ce80
y.create.l HWIO_APPS_SMMU_CB29_PMEVTYPER0_APPS_ADDR A:0x1e3de80
y.create.l HWIO_APPS_SMMU_CB30_PMEVTYPER0_APPS_ADDR A:0x1e3ee80
y.create.l HWIO_APPS_SMMU_CB31_PMEVTYPER0_APPS_ADDR A:0x1e3fe80
y.create.l HWIO_APPS_SMMU_CB0_PMEVTYPER1_APPS_ADDR A:0x1e20e84
y.create.l HWIO_APPS_SMMU_CB1_PMEVTYPER1_APPS_ADDR A:0x1e21e84
y.create.l HWIO_APPS_SMMU_CB2_PMEVTYPER1_APPS_ADDR A:0x1e22e84
y.create.l HWIO_APPS_SMMU_CB3_PMEVTYPER1_APPS_ADDR A:0x1e23e84
y.create.l HWIO_APPS_SMMU_CB4_PMEVTYPER1_APPS_ADDR A:0x1e24e84
y.create.l HWIO_APPS_SMMU_CB5_PMEVTYPER1_APPS_ADDR A:0x1e25e84
y.create.l HWIO_APPS_SMMU_CB6_PMEVTYPER1_APPS_ADDR A:0x1e26e84
y.create.l HWIO_APPS_SMMU_CB7_PMEVTYPER1_APPS_ADDR A:0x1e27e84
y.create.l HWIO_APPS_SMMU_CB8_PMEVTYPER1_APPS_ADDR A:0x1e28e84
y.create.l HWIO_APPS_SMMU_CB9_PMEVTYPER1_APPS_ADDR A:0x1e29e84
y.create.l HWIO_APPS_SMMU_CB10_PMEVTYPER1_APPS_ADDR A:0x1e2ae84
y.create.l HWIO_APPS_SMMU_CB11_PMEVTYPER1_APPS_ADDR A:0x1e2be84
y.create.l HWIO_APPS_SMMU_CB12_PMEVTYPER1_APPS_ADDR A:0x1e2ce84
y.create.l HWIO_APPS_SMMU_CB13_PMEVTYPER1_APPS_ADDR A:0x1e2de84
y.create.l HWIO_APPS_SMMU_CB14_PMEVTYPER1_APPS_ADDR A:0x1e2ee84
y.create.l HWIO_APPS_SMMU_CB15_PMEVTYPER1_APPS_ADDR A:0x1e2fe84
y.create.l HWIO_APPS_SMMU_CB16_PMEVTYPER1_APPS_ADDR A:0x1e30e84
y.create.l HWIO_APPS_SMMU_CB17_PMEVTYPER1_APPS_ADDR A:0x1e31e84
y.create.l HWIO_APPS_SMMU_CB18_PMEVTYPER1_APPS_ADDR A:0x1e32e84
y.create.l HWIO_APPS_SMMU_CB19_PMEVTYPER1_APPS_ADDR A:0x1e33e84
y.create.l HWIO_APPS_SMMU_CB20_PMEVTYPER1_APPS_ADDR A:0x1e34e84
y.create.l HWIO_APPS_SMMU_CB21_PMEVTYPER1_APPS_ADDR A:0x1e35e84
y.create.l HWIO_APPS_SMMU_CB22_PMEVTYPER1_APPS_ADDR A:0x1e36e84
y.create.l HWIO_APPS_SMMU_CB23_PMEVTYPER1_APPS_ADDR A:0x1e37e84
y.create.l HWIO_APPS_SMMU_CB24_PMEVTYPER1_APPS_ADDR A:0x1e38e84
y.create.l HWIO_APPS_SMMU_CB25_PMEVTYPER1_APPS_ADDR A:0x1e39e84
y.create.l HWIO_APPS_SMMU_CB26_PMEVTYPER1_APPS_ADDR A:0x1e3ae84
y.create.l HWIO_APPS_SMMU_CB27_PMEVTYPER1_APPS_ADDR A:0x1e3be84
y.create.l HWIO_APPS_SMMU_CB28_PMEVTYPER1_APPS_ADDR A:0x1e3ce84
y.create.l HWIO_APPS_SMMU_CB29_PMEVTYPER1_APPS_ADDR A:0x1e3de84
y.create.l HWIO_APPS_SMMU_CB30_PMEVTYPER1_APPS_ADDR A:0x1e3ee84
y.create.l HWIO_APPS_SMMU_CB31_PMEVTYPER1_APPS_ADDR A:0x1e3fe84
y.create.l HWIO_APPS_SMMU_CB0_PMEVTYPER2_APPS_ADDR A:0x1e20e88
y.create.l HWIO_APPS_SMMU_CB1_PMEVTYPER2_APPS_ADDR A:0x1e21e88
y.create.l HWIO_APPS_SMMU_CB2_PMEVTYPER2_APPS_ADDR A:0x1e22e88
y.create.l HWIO_APPS_SMMU_CB3_PMEVTYPER2_APPS_ADDR A:0x1e23e88
y.create.l HWIO_APPS_SMMU_CB4_PMEVTYPER2_APPS_ADDR A:0x1e24e88
y.create.l HWIO_APPS_SMMU_CB5_PMEVTYPER2_APPS_ADDR A:0x1e25e88
y.create.l HWIO_APPS_SMMU_CB6_PMEVTYPER2_APPS_ADDR A:0x1e26e88
y.create.l HWIO_APPS_SMMU_CB7_PMEVTYPER2_APPS_ADDR A:0x1e27e88
y.create.l HWIO_APPS_SMMU_CB8_PMEVTYPER2_APPS_ADDR A:0x1e28e88
y.create.l HWIO_APPS_SMMU_CB9_PMEVTYPER2_APPS_ADDR A:0x1e29e88
y.create.l HWIO_APPS_SMMU_CB10_PMEVTYPER2_APPS_ADDR A:0x1e2ae88
y.create.l HWIO_APPS_SMMU_CB11_PMEVTYPER2_APPS_ADDR A:0x1e2be88
y.create.l HWIO_APPS_SMMU_CB12_PMEVTYPER2_APPS_ADDR A:0x1e2ce88
y.create.l HWIO_APPS_SMMU_CB13_PMEVTYPER2_APPS_ADDR A:0x1e2de88
y.create.l HWIO_APPS_SMMU_CB14_PMEVTYPER2_APPS_ADDR A:0x1e2ee88
y.create.l HWIO_APPS_SMMU_CB15_PMEVTYPER2_APPS_ADDR A:0x1e2fe88
y.create.l HWIO_APPS_SMMU_CB16_PMEVTYPER2_APPS_ADDR A:0x1e30e88
y.create.l HWIO_APPS_SMMU_CB17_PMEVTYPER2_APPS_ADDR A:0x1e31e88
y.create.l HWIO_APPS_SMMU_CB18_PMEVTYPER2_APPS_ADDR A:0x1e32e88
y.create.l HWIO_APPS_SMMU_CB19_PMEVTYPER2_APPS_ADDR A:0x1e33e88
y.create.l HWIO_APPS_SMMU_CB20_PMEVTYPER2_APPS_ADDR A:0x1e34e88
y.create.l HWIO_APPS_SMMU_CB21_PMEVTYPER2_APPS_ADDR A:0x1e35e88
y.create.l HWIO_APPS_SMMU_CB22_PMEVTYPER2_APPS_ADDR A:0x1e36e88
y.create.l HWIO_APPS_SMMU_CB23_PMEVTYPER2_APPS_ADDR A:0x1e37e88
y.create.l HWIO_APPS_SMMU_CB24_PMEVTYPER2_APPS_ADDR A:0x1e38e88
y.create.l HWIO_APPS_SMMU_CB25_PMEVTYPER2_APPS_ADDR A:0x1e39e88
y.create.l HWIO_APPS_SMMU_CB26_PMEVTYPER2_APPS_ADDR A:0x1e3ae88
y.create.l HWIO_APPS_SMMU_CB27_PMEVTYPER2_APPS_ADDR A:0x1e3be88
y.create.l HWIO_APPS_SMMU_CB28_PMEVTYPER2_APPS_ADDR A:0x1e3ce88
y.create.l HWIO_APPS_SMMU_CB29_PMEVTYPER2_APPS_ADDR A:0x1e3de88
y.create.l HWIO_APPS_SMMU_CB30_PMEVTYPER2_APPS_ADDR A:0x1e3ee88
y.create.l HWIO_APPS_SMMU_CB31_PMEVTYPER2_APPS_ADDR A:0x1e3fe88
y.create.l HWIO_APPS_SMMU_CB0_PMEVTYPER3_APPS_ADDR A:0x1e20e8c
y.create.l HWIO_APPS_SMMU_CB1_PMEVTYPER3_APPS_ADDR A:0x1e21e8c
y.create.l HWIO_APPS_SMMU_CB2_PMEVTYPER3_APPS_ADDR A:0x1e22e8c
y.create.l HWIO_APPS_SMMU_CB3_PMEVTYPER3_APPS_ADDR A:0x1e23e8c
y.create.l HWIO_APPS_SMMU_CB4_PMEVTYPER3_APPS_ADDR A:0x1e24e8c
y.create.l HWIO_APPS_SMMU_CB5_PMEVTYPER3_APPS_ADDR A:0x1e25e8c
y.create.l HWIO_APPS_SMMU_CB6_PMEVTYPER3_APPS_ADDR A:0x1e26e8c
y.create.l HWIO_APPS_SMMU_CB7_PMEVTYPER3_APPS_ADDR A:0x1e27e8c
y.create.l HWIO_APPS_SMMU_CB8_PMEVTYPER3_APPS_ADDR A:0x1e28e8c
y.create.l HWIO_APPS_SMMU_CB9_PMEVTYPER3_APPS_ADDR A:0x1e29e8c
y.create.l HWIO_APPS_SMMU_CB10_PMEVTYPER3_APPS_ADDR A:0x1e2ae8c
y.create.l HWIO_APPS_SMMU_CB11_PMEVTYPER3_APPS_ADDR A:0x1e2be8c
y.create.l HWIO_APPS_SMMU_CB12_PMEVTYPER3_APPS_ADDR A:0x1e2ce8c
y.create.l HWIO_APPS_SMMU_CB13_PMEVTYPER3_APPS_ADDR A:0x1e2de8c
y.create.l HWIO_APPS_SMMU_CB14_PMEVTYPER3_APPS_ADDR A:0x1e2ee8c
y.create.l HWIO_APPS_SMMU_CB15_PMEVTYPER3_APPS_ADDR A:0x1e2fe8c
y.create.l HWIO_APPS_SMMU_CB16_PMEVTYPER3_APPS_ADDR A:0x1e30e8c
y.create.l HWIO_APPS_SMMU_CB17_PMEVTYPER3_APPS_ADDR A:0x1e31e8c
y.create.l HWIO_APPS_SMMU_CB18_PMEVTYPER3_APPS_ADDR A:0x1e32e8c
y.create.l HWIO_APPS_SMMU_CB19_PMEVTYPER3_APPS_ADDR A:0x1e33e8c
y.create.l HWIO_APPS_SMMU_CB20_PMEVTYPER3_APPS_ADDR A:0x1e34e8c
y.create.l HWIO_APPS_SMMU_CB21_PMEVTYPER3_APPS_ADDR A:0x1e35e8c
y.create.l HWIO_APPS_SMMU_CB22_PMEVTYPER3_APPS_ADDR A:0x1e36e8c
y.create.l HWIO_APPS_SMMU_CB23_PMEVTYPER3_APPS_ADDR A:0x1e37e8c
y.create.l HWIO_APPS_SMMU_CB24_PMEVTYPER3_APPS_ADDR A:0x1e38e8c
y.create.l HWIO_APPS_SMMU_CB25_PMEVTYPER3_APPS_ADDR A:0x1e39e8c
y.create.l HWIO_APPS_SMMU_CB26_PMEVTYPER3_APPS_ADDR A:0x1e3ae8c
y.create.l HWIO_APPS_SMMU_CB27_PMEVTYPER3_APPS_ADDR A:0x1e3be8c
y.create.l HWIO_APPS_SMMU_CB28_PMEVTYPER3_APPS_ADDR A:0x1e3ce8c
y.create.l HWIO_APPS_SMMU_CB29_PMEVTYPER3_APPS_ADDR A:0x1e3de8c
y.create.l HWIO_APPS_SMMU_CB30_PMEVTYPER3_APPS_ADDR A:0x1e3ee8c
y.create.l HWIO_APPS_SMMU_CB31_PMEVTYPER3_APPS_ADDR A:0x1e3fe8c
y.create.l HWIO_APPS_SMMU_CB0_PMCFGR_APPS_ADDR A:0x1e20f00
y.create.l HWIO_APPS_SMMU_CB1_PMCFGR_APPS_ADDR A:0x1e21f00
y.create.l HWIO_APPS_SMMU_CB2_PMCFGR_APPS_ADDR A:0x1e22f00
y.create.l HWIO_APPS_SMMU_CB3_PMCFGR_APPS_ADDR A:0x1e23f00
y.create.l HWIO_APPS_SMMU_CB4_PMCFGR_APPS_ADDR A:0x1e24f00
y.create.l HWIO_APPS_SMMU_CB5_PMCFGR_APPS_ADDR A:0x1e25f00
y.create.l HWIO_APPS_SMMU_CB6_PMCFGR_APPS_ADDR A:0x1e26f00
y.create.l HWIO_APPS_SMMU_CB7_PMCFGR_APPS_ADDR A:0x1e27f00
y.create.l HWIO_APPS_SMMU_CB8_PMCFGR_APPS_ADDR A:0x1e28f00
y.create.l HWIO_APPS_SMMU_CB9_PMCFGR_APPS_ADDR A:0x1e29f00
y.create.l HWIO_APPS_SMMU_CB10_PMCFGR_APPS_ADDR A:0x1e2af00
y.create.l HWIO_APPS_SMMU_CB11_PMCFGR_APPS_ADDR A:0x1e2bf00
y.create.l HWIO_APPS_SMMU_CB12_PMCFGR_APPS_ADDR A:0x1e2cf00
y.create.l HWIO_APPS_SMMU_CB13_PMCFGR_APPS_ADDR A:0x1e2df00
y.create.l HWIO_APPS_SMMU_CB14_PMCFGR_APPS_ADDR A:0x1e2ef00
y.create.l HWIO_APPS_SMMU_CB15_PMCFGR_APPS_ADDR A:0x1e2ff00
y.create.l HWIO_APPS_SMMU_CB16_PMCFGR_APPS_ADDR A:0x1e30f00
y.create.l HWIO_APPS_SMMU_CB17_PMCFGR_APPS_ADDR A:0x1e31f00
y.create.l HWIO_APPS_SMMU_CB18_PMCFGR_APPS_ADDR A:0x1e32f00
y.create.l HWIO_APPS_SMMU_CB19_PMCFGR_APPS_ADDR A:0x1e33f00
y.create.l HWIO_APPS_SMMU_CB20_PMCFGR_APPS_ADDR A:0x1e34f00
y.create.l HWIO_APPS_SMMU_CB21_PMCFGR_APPS_ADDR A:0x1e35f00
y.create.l HWIO_APPS_SMMU_CB22_PMCFGR_APPS_ADDR A:0x1e36f00
y.create.l HWIO_APPS_SMMU_CB23_PMCFGR_APPS_ADDR A:0x1e37f00
y.create.l HWIO_APPS_SMMU_CB24_PMCFGR_APPS_ADDR A:0x1e38f00
y.create.l HWIO_APPS_SMMU_CB25_PMCFGR_APPS_ADDR A:0x1e39f00
y.create.l HWIO_APPS_SMMU_CB26_PMCFGR_APPS_ADDR A:0x1e3af00
y.create.l HWIO_APPS_SMMU_CB27_PMCFGR_APPS_ADDR A:0x1e3bf00
y.create.l HWIO_APPS_SMMU_CB28_PMCFGR_APPS_ADDR A:0x1e3cf00
y.create.l HWIO_APPS_SMMU_CB29_PMCFGR_APPS_ADDR A:0x1e3df00
y.create.l HWIO_APPS_SMMU_CB30_PMCFGR_APPS_ADDR A:0x1e3ef00
y.create.l HWIO_APPS_SMMU_CB31_PMCFGR_APPS_ADDR A:0x1e3ff00
y.create.l HWIO_APPS_SMMU_CB0_PMCR_APPS_ADDR A:0x1e20f04
y.create.l HWIO_APPS_SMMU_CB1_PMCR_APPS_ADDR A:0x1e21f04
y.create.l HWIO_APPS_SMMU_CB2_PMCR_APPS_ADDR A:0x1e22f04
y.create.l HWIO_APPS_SMMU_CB3_PMCR_APPS_ADDR A:0x1e23f04
y.create.l HWIO_APPS_SMMU_CB4_PMCR_APPS_ADDR A:0x1e24f04
y.create.l HWIO_APPS_SMMU_CB5_PMCR_APPS_ADDR A:0x1e25f04
y.create.l HWIO_APPS_SMMU_CB6_PMCR_APPS_ADDR A:0x1e26f04
y.create.l HWIO_APPS_SMMU_CB7_PMCR_APPS_ADDR A:0x1e27f04
y.create.l HWIO_APPS_SMMU_CB8_PMCR_APPS_ADDR A:0x1e28f04
y.create.l HWIO_APPS_SMMU_CB9_PMCR_APPS_ADDR A:0x1e29f04
y.create.l HWIO_APPS_SMMU_CB10_PMCR_APPS_ADDR A:0x1e2af04
y.create.l HWIO_APPS_SMMU_CB11_PMCR_APPS_ADDR A:0x1e2bf04
y.create.l HWIO_APPS_SMMU_CB12_PMCR_APPS_ADDR A:0x1e2cf04
y.create.l HWIO_APPS_SMMU_CB13_PMCR_APPS_ADDR A:0x1e2df04
y.create.l HWIO_APPS_SMMU_CB14_PMCR_APPS_ADDR A:0x1e2ef04
y.create.l HWIO_APPS_SMMU_CB15_PMCR_APPS_ADDR A:0x1e2ff04
y.create.l HWIO_APPS_SMMU_CB16_PMCR_APPS_ADDR A:0x1e30f04
y.create.l HWIO_APPS_SMMU_CB17_PMCR_APPS_ADDR A:0x1e31f04
y.create.l HWIO_APPS_SMMU_CB18_PMCR_APPS_ADDR A:0x1e32f04
y.create.l HWIO_APPS_SMMU_CB19_PMCR_APPS_ADDR A:0x1e33f04
y.create.l HWIO_APPS_SMMU_CB20_PMCR_APPS_ADDR A:0x1e34f04
y.create.l HWIO_APPS_SMMU_CB21_PMCR_APPS_ADDR A:0x1e35f04
y.create.l HWIO_APPS_SMMU_CB22_PMCR_APPS_ADDR A:0x1e36f04
y.create.l HWIO_APPS_SMMU_CB23_PMCR_APPS_ADDR A:0x1e37f04
y.create.l HWIO_APPS_SMMU_CB24_PMCR_APPS_ADDR A:0x1e38f04
y.create.l HWIO_APPS_SMMU_CB25_PMCR_APPS_ADDR A:0x1e39f04
y.create.l HWIO_APPS_SMMU_CB26_PMCR_APPS_ADDR A:0x1e3af04
y.create.l HWIO_APPS_SMMU_CB27_PMCR_APPS_ADDR A:0x1e3bf04
y.create.l HWIO_APPS_SMMU_CB28_PMCR_APPS_ADDR A:0x1e3cf04
y.create.l HWIO_APPS_SMMU_CB29_PMCR_APPS_ADDR A:0x1e3df04
y.create.l HWIO_APPS_SMMU_CB30_PMCR_APPS_ADDR A:0x1e3ef04
y.create.l HWIO_APPS_SMMU_CB31_PMCR_APPS_ADDR A:0x1e3ff04
y.create.l HWIO_APPS_SMMU_CB0_PMCEID_APPS_ADDR A:0x1e20f20
y.create.l HWIO_APPS_SMMU_CB1_PMCEID_APPS_ADDR A:0x1e21f20
y.create.l HWIO_APPS_SMMU_CB2_PMCEID_APPS_ADDR A:0x1e22f20
y.create.l HWIO_APPS_SMMU_CB3_PMCEID_APPS_ADDR A:0x1e23f20
y.create.l HWIO_APPS_SMMU_CB4_PMCEID_APPS_ADDR A:0x1e24f20
y.create.l HWIO_APPS_SMMU_CB5_PMCEID_APPS_ADDR A:0x1e25f20
y.create.l HWIO_APPS_SMMU_CB6_PMCEID_APPS_ADDR A:0x1e26f20
y.create.l HWIO_APPS_SMMU_CB7_PMCEID_APPS_ADDR A:0x1e27f20
y.create.l HWIO_APPS_SMMU_CB8_PMCEID_APPS_ADDR A:0x1e28f20
y.create.l HWIO_APPS_SMMU_CB9_PMCEID_APPS_ADDR A:0x1e29f20
y.create.l HWIO_APPS_SMMU_CB10_PMCEID_APPS_ADDR A:0x1e2af20
y.create.l HWIO_APPS_SMMU_CB11_PMCEID_APPS_ADDR A:0x1e2bf20
y.create.l HWIO_APPS_SMMU_CB12_PMCEID_APPS_ADDR A:0x1e2cf20
y.create.l HWIO_APPS_SMMU_CB13_PMCEID_APPS_ADDR A:0x1e2df20
y.create.l HWIO_APPS_SMMU_CB14_PMCEID_APPS_ADDR A:0x1e2ef20
y.create.l HWIO_APPS_SMMU_CB15_PMCEID_APPS_ADDR A:0x1e2ff20
y.create.l HWIO_APPS_SMMU_CB16_PMCEID_APPS_ADDR A:0x1e30f20
y.create.l HWIO_APPS_SMMU_CB17_PMCEID_APPS_ADDR A:0x1e31f20
y.create.l HWIO_APPS_SMMU_CB18_PMCEID_APPS_ADDR A:0x1e32f20
y.create.l HWIO_APPS_SMMU_CB19_PMCEID_APPS_ADDR A:0x1e33f20
y.create.l HWIO_APPS_SMMU_CB20_PMCEID_APPS_ADDR A:0x1e34f20
y.create.l HWIO_APPS_SMMU_CB21_PMCEID_APPS_ADDR A:0x1e35f20
y.create.l HWIO_APPS_SMMU_CB22_PMCEID_APPS_ADDR A:0x1e36f20
y.create.l HWIO_APPS_SMMU_CB23_PMCEID_APPS_ADDR A:0x1e37f20
y.create.l HWIO_APPS_SMMU_CB24_PMCEID_APPS_ADDR A:0x1e38f20
y.create.l HWIO_APPS_SMMU_CB25_PMCEID_APPS_ADDR A:0x1e39f20
y.create.l HWIO_APPS_SMMU_CB26_PMCEID_APPS_ADDR A:0x1e3af20
y.create.l HWIO_APPS_SMMU_CB27_PMCEID_APPS_ADDR A:0x1e3bf20
y.create.l HWIO_APPS_SMMU_CB28_PMCEID_APPS_ADDR A:0x1e3cf20
y.create.l HWIO_APPS_SMMU_CB29_PMCEID_APPS_ADDR A:0x1e3df20
y.create.l HWIO_APPS_SMMU_CB30_PMCEID_APPS_ADDR A:0x1e3ef20
y.create.l HWIO_APPS_SMMU_CB31_PMCEID_APPS_ADDR A:0x1e3ff20
y.create.l HWIO_APPS_SMMU_CB0_PMCNTENSE_APPS_ADDR A:0x1e20f40
y.create.l HWIO_APPS_SMMU_CB1_PMCNTENSE_APPS_ADDR A:0x1e21f40
y.create.l HWIO_APPS_SMMU_CB2_PMCNTENSE_APPS_ADDR A:0x1e22f40
y.create.l HWIO_APPS_SMMU_CB3_PMCNTENSE_APPS_ADDR A:0x1e23f40
y.create.l HWIO_APPS_SMMU_CB4_PMCNTENSE_APPS_ADDR A:0x1e24f40
y.create.l HWIO_APPS_SMMU_CB5_PMCNTENSE_APPS_ADDR A:0x1e25f40
y.create.l HWIO_APPS_SMMU_CB6_PMCNTENSE_APPS_ADDR A:0x1e26f40
y.create.l HWIO_APPS_SMMU_CB7_PMCNTENSE_APPS_ADDR A:0x1e27f40
y.create.l HWIO_APPS_SMMU_CB8_PMCNTENSE_APPS_ADDR A:0x1e28f40
y.create.l HWIO_APPS_SMMU_CB9_PMCNTENSE_APPS_ADDR A:0x1e29f40
y.create.l HWIO_APPS_SMMU_CB10_PMCNTENSE_APPS_ADDR A:0x1e2af40
y.create.l HWIO_APPS_SMMU_CB11_PMCNTENSE_APPS_ADDR A:0x1e2bf40
y.create.l HWIO_APPS_SMMU_CB12_PMCNTENSE_APPS_ADDR A:0x1e2cf40
y.create.l HWIO_APPS_SMMU_CB13_PMCNTENSE_APPS_ADDR A:0x1e2df40
y.create.l HWIO_APPS_SMMU_CB14_PMCNTENSE_APPS_ADDR A:0x1e2ef40
y.create.l HWIO_APPS_SMMU_CB15_PMCNTENSE_APPS_ADDR A:0x1e2ff40
y.create.l HWIO_APPS_SMMU_CB16_PMCNTENSE_APPS_ADDR A:0x1e30f40
y.create.l HWIO_APPS_SMMU_CB17_PMCNTENSE_APPS_ADDR A:0x1e31f40
y.create.l HWIO_APPS_SMMU_CB18_PMCNTENSE_APPS_ADDR A:0x1e32f40
y.create.l HWIO_APPS_SMMU_CB19_PMCNTENSE_APPS_ADDR A:0x1e33f40
y.create.l HWIO_APPS_SMMU_CB20_PMCNTENSE_APPS_ADDR A:0x1e34f40
y.create.l HWIO_APPS_SMMU_CB21_PMCNTENSE_APPS_ADDR A:0x1e35f40
y.create.l HWIO_APPS_SMMU_CB22_PMCNTENSE_APPS_ADDR A:0x1e36f40
y.create.l HWIO_APPS_SMMU_CB23_PMCNTENSE_APPS_ADDR A:0x1e37f40
y.create.l HWIO_APPS_SMMU_CB24_PMCNTENSE_APPS_ADDR A:0x1e38f40
y.create.l HWIO_APPS_SMMU_CB25_PMCNTENSE_APPS_ADDR A:0x1e39f40
y.create.l HWIO_APPS_SMMU_CB26_PMCNTENSE_APPS_ADDR A:0x1e3af40
y.create.l HWIO_APPS_SMMU_CB27_PMCNTENSE_APPS_ADDR A:0x1e3bf40
y.create.l HWIO_APPS_SMMU_CB28_PMCNTENSE_APPS_ADDR A:0x1e3cf40
y.create.l HWIO_APPS_SMMU_CB29_PMCNTENSE_APPS_ADDR A:0x1e3df40
y.create.l HWIO_APPS_SMMU_CB30_PMCNTENSE_APPS_ADDR A:0x1e3ef40
y.create.l HWIO_APPS_SMMU_CB31_PMCNTENSE_APPS_ADDR A:0x1e3ff40
y.create.l HWIO_APPS_SMMU_CB0_PMCNTENCLR_APPS_ADDR A:0x1e20f44
y.create.l HWIO_APPS_SMMU_CB1_PMCNTENCLR_APPS_ADDR A:0x1e21f44
y.create.l HWIO_APPS_SMMU_CB2_PMCNTENCLR_APPS_ADDR A:0x1e22f44
y.create.l HWIO_APPS_SMMU_CB3_PMCNTENCLR_APPS_ADDR A:0x1e23f44
y.create.l HWIO_APPS_SMMU_CB4_PMCNTENCLR_APPS_ADDR A:0x1e24f44
y.create.l HWIO_APPS_SMMU_CB5_PMCNTENCLR_APPS_ADDR A:0x1e25f44
y.create.l HWIO_APPS_SMMU_CB6_PMCNTENCLR_APPS_ADDR A:0x1e26f44
y.create.l HWIO_APPS_SMMU_CB7_PMCNTENCLR_APPS_ADDR A:0x1e27f44
y.create.l HWIO_APPS_SMMU_CB8_PMCNTENCLR_APPS_ADDR A:0x1e28f44
y.create.l HWIO_APPS_SMMU_CB9_PMCNTENCLR_APPS_ADDR A:0x1e29f44
y.create.l HWIO_APPS_SMMU_CB10_PMCNTENCLR_APPS_ADDR A:0x1e2af44
y.create.l HWIO_APPS_SMMU_CB11_PMCNTENCLR_APPS_ADDR A:0x1e2bf44
y.create.l HWIO_APPS_SMMU_CB12_PMCNTENCLR_APPS_ADDR A:0x1e2cf44
y.create.l HWIO_APPS_SMMU_CB13_PMCNTENCLR_APPS_ADDR A:0x1e2df44
y.create.l HWIO_APPS_SMMU_CB14_PMCNTENCLR_APPS_ADDR A:0x1e2ef44
y.create.l HWIO_APPS_SMMU_CB15_PMCNTENCLR_APPS_ADDR A:0x1e2ff44
y.create.l HWIO_APPS_SMMU_CB16_PMCNTENCLR_APPS_ADDR A:0x1e30f44
y.create.l HWIO_APPS_SMMU_CB17_PMCNTENCLR_APPS_ADDR A:0x1e31f44
y.create.l HWIO_APPS_SMMU_CB18_PMCNTENCLR_APPS_ADDR A:0x1e32f44
y.create.l HWIO_APPS_SMMU_CB19_PMCNTENCLR_APPS_ADDR A:0x1e33f44
y.create.l HWIO_APPS_SMMU_CB20_PMCNTENCLR_APPS_ADDR A:0x1e34f44
y.create.l HWIO_APPS_SMMU_CB21_PMCNTENCLR_APPS_ADDR A:0x1e35f44
y.create.l HWIO_APPS_SMMU_CB22_PMCNTENCLR_APPS_ADDR A:0x1e36f44
y.create.l HWIO_APPS_SMMU_CB23_PMCNTENCLR_APPS_ADDR A:0x1e37f44
y.create.l HWIO_APPS_SMMU_CB24_PMCNTENCLR_APPS_ADDR A:0x1e38f44
y.create.l HWIO_APPS_SMMU_CB25_PMCNTENCLR_APPS_ADDR A:0x1e39f44
y.create.l HWIO_APPS_SMMU_CB26_PMCNTENCLR_APPS_ADDR A:0x1e3af44
y.create.l HWIO_APPS_SMMU_CB27_PMCNTENCLR_APPS_ADDR A:0x1e3bf44
y.create.l HWIO_APPS_SMMU_CB28_PMCNTENCLR_APPS_ADDR A:0x1e3cf44
y.create.l HWIO_APPS_SMMU_CB29_PMCNTENCLR_APPS_ADDR A:0x1e3df44
y.create.l HWIO_APPS_SMMU_CB30_PMCNTENCLR_APPS_ADDR A:0x1e3ef44
y.create.l HWIO_APPS_SMMU_CB31_PMCNTENCLR_APPS_ADDR A:0x1e3ff44
y.create.l HWIO_APPS_SMMU_CB0_PMCNTENSET_APPS_ADDR A:0x1e20f48
y.create.l HWIO_APPS_SMMU_CB1_PMCNTENSET_APPS_ADDR A:0x1e21f48
y.create.l HWIO_APPS_SMMU_CB2_PMCNTENSET_APPS_ADDR A:0x1e22f48
y.create.l HWIO_APPS_SMMU_CB3_PMCNTENSET_APPS_ADDR A:0x1e23f48
y.create.l HWIO_APPS_SMMU_CB4_PMCNTENSET_APPS_ADDR A:0x1e24f48
y.create.l HWIO_APPS_SMMU_CB5_PMCNTENSET_APPS_ADDR A:0x1e25f48
y.create.l HWIO_APPS_SMMU_CB6_PMCNTENSET_APPS_ADDR A:0x1e26f48
y.create.l HWIO_APPS_SMMU_CB7_PMCNTENSET_APPS_ADDR A:0x1e27f48
y.create.l HWIO_APPS_SMMU_CB8_PMCNTENSET_APPS_ADDR A:0x1e28f48
y.create.l HWIO_APPS_SMMU_CB9_PMCNTENSET_APPS_ADDR A:0x1e29f48
y.create.l HWIO_APPS_SMMU_CB10_PMCNTENSET_APPS_ADDR A:0x1e2af48
y.create.l HWIO_APPS_SMMU_CB11_PMCNTENSET_APPS_ADDR A:0x1e2bf48
y.create.l HWIO_APPS_SMMU_CB12_PMCNTENSET_APPS_ADDR A:0x1e2cf48
y.create.l HWIO_APPS_SMMU_CB13_PMCNTENSET_APPS_ADDR A:0x1e2df48
y.create.l HWIO_APPS_SMMU_CB14_PMCNTENSET_APPS_ADDR A:0x1e2ef48
y.create.l HWIO_APPS_SMMU_CB15_PMCNTENSET_APPS_ADDR A:0x1e2ff48
y.create.l HWIO_APPS_SMMU_CB16_PMCNTENSET_APPS_ADDR A:0x1e30f48
y.create.l HWIO_APPS_SMMU_CB17_PMCNTENSET_APPS_ADDR A:0x1e31f48
y.create.l HWIO_APPS_SMMU_CB18_PMCNTENSET_APPS_ADDR A:0x1e32f48
y.create.l HWIO_APPS_SMMU_CB19_PMCNTENSET_APPS_ADDR A:0x1e33f48
y.create.l HWIO_APPS_SMMU_CB20_PMCNTENSET_APPS_ADDR A:0x1e34f48
y.create.l HWIO_APPS_SMMU_CB21_PMCNTENSET_APPS_ADDR A:0x1e35f48
y.create.l HWIO_APPS_SMMU_CB22_PMCNTENSET_APPS_ADDR A:0x1e36f48
y.create.l HWIO_APPS_SMMU_CB23_PMCNTENSET_APPS_ADDR A:0x1e37f48
y.create.l HWIO_APPS_SMMU_CB24_PMCNTENSET_APPS_ADDR A:0x1e38f48
y.create.l HWIO_APPS_SMMU_CB25_PMCNTENSET_APPS_ADDR A:0x1e39f48
y.create.l HWIO_APPS_SMMU_CB26_PMCNTENSET_APPS_ADDR A:0x1e3af48
y.create.l HWIO_APPS_SMMU_CB27_PMCNTENSET_APPS_ADDR A:0x1e3bf48
y.create.l HWIO_APPS_SMMU_CB28_PMCNTENSET_APPS_ADDR A:0x1e3cf48
y.create.l HWIO_APPS_SMMU_CB29_PMCNTENSET_APPS_ADDR A:0x1e3df48
y.create.l HWIO_APPS_SMMU_CB30_PMCNTENSET_APPS_ADDR A:0x1e3ef48
y.create.l HWIO_APPS_SMMU_CB31_PMCNTENSET_APPS_ADDR A:0x1e3ff48
y.create.l HWIO_APPS_SMMU_CB0_PMINTENCLR_APPS_ADDR A:0x1e20f4c
y.create.l HWIO_APPS_SMMU_CB1_PMINTENCLR_APPS_ADDR A:0x1e21f4c
y.create.l HWIO_APPS_SMMU_CB2_PMINTENCLR_APPS_ADDR A:0x1e22f4c
y.create.l HWIO_APPS_SMMU_CB3_PMINTENCLR_APPS_ADDR A:0x1e23f4c
y.create.l HWIO_APPS_SMMU_CB4_PMINTENCLR_APPS_ADDR A:0x1e24f4c
y.create.l HWIO_APPS_SMMU_CB5_PMINTENCLR_APPS_ADDR A:0x1e25f4c
y.create.l HWIO_APPS_SMMU_CB6_PMINTENCLR_APPS_ADDR A:0x1e26f4c
y.create.l HWIO_APPS_SMMU_CB7_PMINTENCLR_APPS_ADDR A:0x1e27f4c
y.create.l HWIO_APPS_SMMU_CB8_PMINTENCLR_APPS_ADDR A:0x1e28f4c
y.create.l HWIO_APPS_SMMU_CB9_PMINTENCLR_APPS_ADDR A:0x1e29f4c
y.create.l HWIO_APPS_SMMU_CB10_PMINTENCLR_APPS_ADDR A:0x1e2af4c
y.create.l HWIO_APPS_SMMU_CB11_PMINTENCLR_APPS_ADDR A:0x1e2bf4c
y.create.l HWIO_APPS_SMMU_CB12_PMINTENCLR_APPS_ADDR A:0x1e2cf4c
y.create.l HWIO_APPS_SMMU_CB13_PMINTENCLR_APPS_ADDR A:0x1e2df4c
y.create.l HWIO_APPS_SMMU_CB14_PMINTENCLR_APPS_ADDR A:0x1e2ef4c
y.create.l HWIO_APPS_SMMU_CB15_PMINTENCLR_APPS_ADDR A:0x1e2ff4c
y.create.l HWIO_APPS_SMMU_CB16_PMINTENCLR_APPS_ADDR A:0x1e30f4c
y.create.l HWIO_APPS_SMMU_CB17_PMINTENCLR_APPS_ADDR A:0x1e31f4c
y.create.l HWIO_APPS_SMMU_CB18_PMINTENCLR_APPS_ADDR A:0x1e32f4c
y.create.l HWIO_APPS_SMMU_CB19_PMINTENCLR_APPS_ADDR A:0x1e33f4c
y.create.l HWIO_APPS_SMMU_CB20_PMINTENCLR_APPS_ADDR A:0x1e34f4c
y.create.l HWIO_APPS_SMMU_CB21_PMINTENCLR_APPS_ADDR A:0x1e35f4c
y.create.l HWIO_APPS_SMMU_CB22_PMINTENCLR_APPS_ADDR A:0x1e36f4c
y.create.l HWIO_APPS_SMMU_CB23_PMINTENCLR_APPS_ADDR A:0x1e37f4c
y.create.l HWIO_APPS_SMMU_CB24_PMINTENCLR_APPS_ADDR A:0x1e38f4c
y.create.l HWIO_APPS_SMMU_CB25_PMINTENCLR_APPS_ADDR A:0x1e39f4c
y.create.l HWIO_APPS_SMMU_CB26_PMINTENCLR_APPS_ADDR A:0x1e3af4c
y.create.l HWIO_APPS_SMMU_CB27_PMINTENCLR_APPS_ADDR A:0x1e3bf4c
y.create.l HWIO_APPS_SMMU_CB28_PMINTENCLR_APPS_ADDR A:0x1e3cf4c
y.create.l HWIO_APPS_SMMU_CB29_PMINTENCLR_APPS_ADDR A:0x1e3df4c
y.create.l HWIO_APPS_SMMU_CB30_PMINTENCLR_APPS_ADDR A:0x1e3ef4c
y.create.l HWIO_APPS_SMMU_CB31_PMINTENCLR_APPS_ADDR A:0x1e3ff4c
y.create.l HWIO_APPS_SMMU_CB0_PMOVSCLR_APPS_ADDR A:0x1e20f50
y.create.l HWIO_APPS_SMMU_CB1_PMOVSCLR_APPS_ADDR A:0x1e21f50
y.create.l HWIO_APPS_SMMU_CB2_PMOVSCLR_APPS_ADDR A:0x1e22f50
y.create.l HWIO_APPS_SMMU_CB3_PMOVSCLR_APPS_ADDR A:0x1e23f50
y.create.l HWIO_APPS_SMMU_CB4_PMOVSCLR_APPS_ADDR A:0x1e24f50
y.create.l HWIO_APPS_SMMU_CB5_PMOVSCLR_APPS_ADDR A:0x1e25f50
y.create.l HWIO_APPS_SMMU_CB6_PMOVSCLR_APPS_ADDR A:0x1e26f50
y.create.l HWIO_APPS_SMMU_CB7_PMOVSCLR_APPS_ADDR A:0x1e27f50
y.create.l HWIO_APPS_SMMU_CB8_PMOVSCLR_APPS_ADDR A:0x1e28f50
y.create.l HWIO_APPS_SMMU_CB9_PMOVSCLR_APPS_ADDR A:0x1e29f50
y.create.l HWIO_APPS_SMMU_CB10_PMOVSCLR_APPS_ADDR A:0x1e2af50
y.create.l HWIO_APPS_SMMU_CB11_PMOVSCLR_APPS_ADDR A:0x1e2bf50
y.create.l HWIO_APPS_SMMU_CB12_PMOVSCLR_APPS_ADDR A:0x1e2cf50
y.create.l HWIO_APPS_SMMU_CB13_PMOVSCLR_APPS_ADDR A:0x1e2df50
y.create.l HWIO_APPS_SMMU_CB14_PMOVSCLR_APPS_ADDR A:0x1e2ef50
y.create.l HWIO_APPS_SMMU_CB15_PMOVSCLR_APPS_ADDR A:0x1e2ff50
y.create.l HWIO_APPS_SMMU_CB16_PMOVSCLR_APPS_ADDR A:0x1e30f50
y.create.l HWIO_APPS_SMMU_CB17_PMOVSCLR_APPS_ADDR A:0x1e31f50
y.create.l HWIO_APPS_SMMU_CB18_PMOVSCLR_APPS_ADDR A:0x1e32f50
y.create.l HWIO_APPS_SMMU_CB19_PMOVSCLR_APPS_ADDR A:0x1e33f50
y.create.l HWIO_APPS_SMMU_CB20_PMOVSCLR_APPS_ADDR A:0x1e34f50
y.create.l HWIO_APPS_SMMU_CB21_PMOVSCLR_APPS_ADDR A:0x1e35f50
y.create.l HWIO_APPS_SMMU_CB22_PMOVSCLR_APPS_ADDR A:0x1e36f50
y.create.l HWIO_APPS_SMMU_CB23_PMOVSCLR_APPS_ADDR A:0x1e37f50
y.create.l HWIO_APPS_SMMU_CB24_PMOVSCLR_APPS_ADDR A:0x1e38f50
y.create.l HWIO_APPS_SMMU_CB25_PMOVSCLR_APPS_ADDR A:0x1e39f50
y.create.l HWIO_APPS_SMMU_CB26_PMOVSCLR_APPS_ADDR A:0x1e3af50
y.create.l HWIO_APPS_SMMU_CB27_PMOVSCLR_APPS_ADDR A:0x1e3bf50
y.create.l HWIO_APPS_SMMU_CB28_PMOVSCLR_APPS_ADDR A:0x1e3cf50
y.create.l HWIO_APPS_SMMU_CB29_PMOVSCLR_APPS_ADDR A:0x1e3df50
y.create.l HWIO_APPS_SMMU_CB30_PMOVSCLR_APPS_ADDR A:0x1e3ef50
y.create.l HWIO_APPS_SMMU_CB31_PMOVSCLR_APPS_ADDR A:0x1e3ff50
y.create.l HWIO_APPS_SMMU_CB0_PMOVSSET_APPS_ADDR A:0x1e20f58
y.create.l HWIO_APPS_SMMU_CB1_PMOVSSET_APPS_ADDR A:0x1e21f58
y.create.l HWIO_APPS_SMMU_CB2_PMOVSSET_APPS_ADDR A:0x1e22f58
y.create.l HWIO_APPS_SMMU_CB3_PMOVSSET_APPS_ADDR A:0x1e23f58
y.create.l HWIO_APPS_SMMU_CB4_PMOVSSET_APPS_ADDR A:0x1e24f58
y.create.l HWIO_APPS_SMMU_CB5_PMOVSSET_APPS_ADDR A:0x1e25f58
y.create.l HWIO_APPS_SMMU_CB6_PMOVSSET_APPS_ADDR A:0x1e26f58
y.create.l HWIO_APPS_SMMU_CB7_PMOVSSET_APPS_ADDR A:0x1e27f58
y.create.l HWIO_APPS_SMMU_CB8_PMOVSSET_APPS_ADDR A:0x1e28f58
y.create.l HWIO_APPS_SMMU_CB9_PMOVSSET_APPS_ADDR A:0x1e29f58
y.create.l HWIO_APPS_SMMU_CB10_PMOVSSET_APPS_ADDR A:0x1e2af58
y.create.l HWIO_APPS_SMMU_CB11_PMOVSSET_APPS_ADDR A:0x1e2bf58
y.create.l HWIO_APPS_SMMU_CB12_PMOVSSET_APPS_ADDR A:0x1e2cf58
y.create.l HWIO_APPS_SMMU_CB13_PMOVSSET_APPS_ADDR A:0x1e2df58
y.create.l HWIO_APPS_SMMU_CB14_PMOVSSET_APPS_ADDR A:0x1e2ef58
y.create.l HWIO_APPS_SMMU_CB15_PMOVSSET_APPS_ADDR A:0x1e2ff58
y.create.l HWIO_APPS_SMMU_CB16_PMOVSSET_APPS_ADDR A:0x1e30f58
y.create.l HWIO_APPS_SMMU_CB17_PMOVSSET_APPS_ADDR A:0x1e31f58
y.create.l HWIO_APPS_SMMU_CB18_PMOVSSET_APPS_ADDR A:0x1e32f58
y.create.l HWIO_APPS_SMMU_CB19_PMOVSSET_APPS_ADDR A:0x1e33f58
y.create.l HWIO_APPS_SMMU_CB20_PMOVSSET_APPS_ADDR A:0x1e34f58
y.create.l HWIO_APPS_SMMU_CB21_PMOVSSET_APPS_ADDR A:0x1e35f58
y.create.l HWIO_APPS_SMMU_CB22_PMOVSSET_APPS_ADDR A:0x1e36f58
y.create.l HWIO_APPS_SMMU_CB23_PMOVSSET_APPS_ADDR A:0x1e37f58
y.create.l HWIO_APPS_SMMU_CB24_PMOVSSET_APPS_ADDR A:0x1e38f58
y.create.l HWIO_APPS_SMMU_CB25_PMOVSSET_APPS_ADDR A:0x1e39f58
y.create.l HWIO_APPS_SMMU_CB26_PMOVSSET_APPS_ADDR A:0x1e3af58
y.create.l HWIO_APPS_SMMU_CB27_PMOVSSET_APPS_ADDR A:0x1e3bf58
y.create.l HWIO_APPS_SMMU_CB28_PMOVSSET_APPS_ADDR A:0x1e3cf58
y.create.l HWIO_APPS_SMMU_CB29_PMOVSSET_APPS_ADDR A:0x1e3df58
y.create.l HWIO_APPS_SMMU_CB30_PMOVSSET_APPS_ADDR A:0x1e3ef58
y.create.l HWIO_APPS_SMMU_CB31_PMOVSSET_APPS_ADDR A:0x1e3ff58
y.create.l HWIO_APPS_SMMU_CB0_PMAUTHSTATUS_APPS_ADDR A:0x1e20fb8
y.create.l HWIO_APPS_SMMU_CB1_PMAUTHSTATUS_APPS_ADDR A:0x1e21fb8
y.create.l HWIO_APPS_SMMU_CB2_PMAUTHSTATUS_APPS_ADDR A:0x1e22fb8
y.create.l HWIO_APPS_SMMU_CB3_PMAUTHSTATUS_APPS_ADDR A:0x1e23fb8
y.create.l HWIO_APPS_SMMU_CB4_PMAUTHSTATUS_APPS_ADDR A:0x1e24fb8
y.create.l HWIO_APPS_SMMU_CB5_PMAUTHSTATUS_APPS_ADDR A:0x1e25fb8
y.create.l HWIO_APPS_SMMU_CB6_PMAUTHSTATUS_APPS_ADDR A:0x1e26fb8
y.create.l HWIO_APPS_SMMU_CB7_PMAUTHSTATUS_APPS_ADDR A:0x1e27fb8
y.create.l HWIO_APPS_SMMU_CB8_PMAUTHSTATUS_APPS_ADDR A:0x1e28fb8
y.create.l HWIO_APPS_SMMU_CB9_PMAUTHSTATUS_APPS_ADDR A:0x1e29fb8
y.create.l HWIO_APPS_SMMU_CB10_PMAUTHSTATUS_APPS_ADDR A:0x1e2afb8
y.create.l HWIO_APPS_SMMU_CB11_PMAUTHSTATUS_APPS_ADDR A:0x1e2bfb8
y.create.l HWIO_APPS_SMMU_CB12_PMAUTHSTATUS_APPS_ADDR A:0x1e2cfb8
y.create.l HWIO_APPS_SMMU_CB13_PMAUTHSTATUS_APPS_ADDR A:0x1e2dfb8
y.create.l HWIO_APPS_SMMU_CB14_PMAUTHSTATUS_APPS_ADDR A:0x1e2efb8
y.create.l HWIO_APPS_SMMU_CB15_PMAUTHSTATUS_APPS_ADDR A:0x1e2ffb8
y.create.l HWIO_APPS_SMMU_CB16_PMAUTHSTATUS_APPS_ADDR A:0x1e30fb8
y.create.l HWIO_APPS_SMMU_CB17_PMAUTHSTATUS_APPS_ADDR A:0x1e31fb8
y.create.l HWIO_APPS_SMMU_CB18_PMAUTHSTATUS_APPS_ADDR A:0x1e32fb8
y.create.l HWIO_APPS_SMMU_CB19_PMAUTHSTATUS_APPS_ADDR A:0x1e33fb8
y.create.l HWIO_APPS_SMMU_CB20_PMAUTHSTATUS_APPS_ADDR A:0x1e34fb8
y.create.l HWIO_APPS_SMMU_CB21_PMAUTHSTATUS_APPS_ADDR A:0x1e35fb8
y.create.l HWIO_APPS_SMMU_CB22_PMAUTHSTATUS_APPS_ADDR A:0x1e36fb8
y.create.l HWIO_APPS_SMMU_CB23_PMAUTHSTATUS_APPS_ADDR A:0x1e37fb8
y.create.l HWIO_APPS_SMMU_CB24_PMAUTHSTATUS_APPS_ADDR A:0x1e38fb8
y.create.l HWIO_APPS_SMMU_CB25_PMAUTHSTATUS_APPS_ADDR A:0x1e39fb8
y.create.l HWIO_APPS_SMMU_CB26_PMAUTHSTATUS_APPS_ADDR A:0x1e3afb8
y.create.l HWIO_APPS_SMMU_CB27_PMAUTHSTATUS_APPS_ADDR A:0x1e3bfb8
y.create.l HWIO_APPS_SMMU_CB28_PMAUTHSTATUS_APPS_ADDR A:0x1e3cfb8
y.create.l HWIO_APPS_SMMU_CB29_PMAUTHSTATUS_APPS_ADDR A:0x1e3dfb8
y.create.l HWIO_APPS_SMMU_CB30_PMAUTHSTATUS_APPS_ADDR A:0x1e3efb8
y.create.l HWIO_APPS_SMMU_CB31_PMAUTHSTATUS_APPS_ADDR A:0x1e3ffb8
y.create.l HWIO_APPS_SMMU_CR0_APPS_ADDR A:0x1e00000
y.create.l HWIO_APPS_SMMU_ACR_APPS_ADDR A:0x1e00010
y.create.l HWIO_APPS_SMMU_IDR0_APPS_ADDR A:0x1e00020
y.create.l HWIO_APPS_SMMU_IDR1_APPS_ADDR A:0x1e00024
y.create.l HWIO_APPS_SMMU_IDR2_APPS_ADDR A:0x1e00028
y.create.l HWIO_APPS_SMMU_IDR7_APPS_ADDR A:0x1e0003c
y.create.l HWIO_APPS_SMMU_GFAR_LOW_APPS_ADDR A:0x1e00040
y.create.l HWIO_APPS_SMMU_GFAR_HIGH_APPS_ADDR A:0x1e00044
y.create.l HWIO_APPS_SMMU_GFSR_APPS_ADDR A:0x1e00048
y.create.l HWIO_APPS_SMMU_GFSRRESTORE_APPS_ADDR A:0x1e0004c
y.create.l HWIO_APPS_SMMU_GFSYNR0_APPS_ADDR A:0x1e00050
y.create.l HWIO_APPS_SMMU_GFSYNR1_APPS_ADDR A:0x1e00054
y.create.l HWIO_APPS_SMMU_TLBIVMID_2_APPS_ADDR A:0x1e00064
y.create.l HWIO_APPS_SMMU_TLBIALLNSNH_2_APPS_ADDR A:0x1e00068
y.create.l HWIO_APPS_SMMU_TLBIALLH_APPS_ADDR A:0x1e0006c
y.create.l HWIO_APPS_SMMU_TLBGSYNC_APPS_ADDR A:0x1e00070
y.create.l HWIO_APPS_SMMU_TLBGSTATUS_APPS_ADDR A:0x1e00074
y.create.l HWIO_APPS_SMMU_TLBIVAH_LOW_APPS_ADDR A:0x1e00078
y.create.l HWIO_APPS_SMMU_TLBIVALH64_LOW_APPS_ADDR A:0x1e000b0
y.create.l HWIO_APPS_SMMU_TLBIVALH64_HIGH_APPS_ADDR A:0x1e000b4
y.create.l HWIO_APPS_SMMU_TLBIVMIDS1_APPS_ADDR A:0x1e000b8
y.create.l HWIO_APPS_SMMU_TLBIVAH64_LOW_APPS_ADDR A:0x1e000c0
y.create.l HWIO_APPS_SMMU_TLBIVAH64_HIGH_APPS_ADDR A:0x1e000c4
y.create.l HWIO_APPS_SMMU_SMR0_2_APPS_ADDR A:0x1e00800
y.create.l HWIO_APPS_SMMU_SMR1_2_APPS_ADDR A:0x1e00804
y.create.l HWIO_APPS_SMMU_SMR2_2_APPS_ADDR A:0x1e00808
y.create.l HWIO_APPS_SMMU_SMR3_2_APPS_ADDR A:0x1e0080c
y.create.l HWIO_APPS_SMMU_SMR4_2_APPS_ADDR A:0x1e00810
y.create.l HWIO_APPS_SMMU_SMR5_2_APPS_ADDR A:0x1e00814
y.create.l HWIO_APPS_SMMU_SMR6_2_APPS_ADDR A:0x1e00818
y.create.l HWIO_APPS_SMMU_SMR7_2_APPS_ADDR A:0x1e0081c
y.create.l HWIO_APPS_SMMU_SMR8_2_APPS_ADDR A:0x1e00820
y.create.l HWIO_APPS_SMMU_SMR9_2_APPS_ADDR A:0x1e00824
y.create.l HWIO_APPS_SMMU_SMR10_2_APPS_ADDR A:0x1e00828
y.create.l HWIO_APPS_SMMU_SMR11_2_APPS_ADDR A:0x1e0082c
y.create.l HWIO_APPS_SMMU_SMR12_2_APPS_ADDR A:0x1e00830
y.create.l HWIO_APPS_SMMU_SMR13_2_APPS_ADDR A:0x1e00834
y.create.l HWIO_APPS_SMMU_SMR14_2_APPS_ADDR A:0x1e00838
y.create.l HWIO_APPS_SMMU_SMR15_2_APPS_ADDR A:0x1e0083c
y.create.l HWIO_APPS_SMMU_SMR16_2_APPS_ADDR A:0x1e00840
y.create.l HWIO_APPS_SMMU_SMR17_2_APPS_ADDR A:0x1e00844
y.create.l HWIO_APPS_SMMU_SMR18_2_APPS_ADDR A:0x1e00848
y.create.l HWIO_APPS_SMMU_SMR19_2_APPS_ADDR A:0x1e0084c
y.create.l HWIO_APPS_SMMU_SMR20_2_APPS_ADDR A:0x1e00850
y.create.l HWIO_APPS_SMMU_SMR21_2_APPS_ADDR A:0x1e00854
y.create.l HWIO_APPS_SMMU_SMR22_2_APPS_ADDR A:0x1e00858
y.create.l HWIO_APPS_SMMU_SMR23_2_APPS_ADDR A:0x1e0085c
y.create.l HWIO_APPS_SMMU_SMR24_2_APPS_ADDR A:0x1e00860
y.create.l HWIO_APPS_SMMU_SMR25_2_APPS_ADDR A:0x1e00864
y.create.l HWIO_APPS_SMMU_SMR26_2_APPS_ADDR A:0x1e00868
y.create.l HWIO_APPS_SMMU_SMR27_2_APPS_ADDR A:0x1e0086c
y.create.l HWIO_APPS_SMMU_SMR28_2_APPS_ADDR A:0x1e00870
y.create.l HWIO_APPS_SMMU_SMR29_2_APPS_ADDR A:0x1e00874
y.create.l HWIO_APPS_SMMU_SMR30_2_APPS_ADDR A:0x1e00878
y.create.l HWIO_APPS_SMMU_SMR31_2_APPS_ADDR A:0x1e0087c
y.create.l HWIO_APPS_SMMU_SMR32_2_APPS_ADDR A:0x1e00880
y.create.l HWIO_APPS_SMMU_SMR33_2_APPS_ADDR A:0x1e00884
y.create.l HWIO_APPS_SMMU_SMR34_2_APPS_ADDR A:0x1e00888
y.create.l HWIO_APPS_SMMU_SMR35_2_APPS_ADDR A:0x1e0088c
y.create.l HWIO_APPS_SMMU_SMR36_2_APPS_ADDR A:0x1e00890
y.create.l HWIO_APPS_SMMU_SMR37_2_APPS_ADDR A:0x1e00894
y.create.l HWIO_APPS_SMMU_SMR38_2_APPS_ADDR A:0x1e00898
y.create.l HWIO_APPS_SMMU_SMR39_2_APPS_ADDR A:0x1e0089c
y.create.l HWIO_APPS_SMMU_SMR40_2_APPS_ADDR A:0x1e008a0
y.create.l HWIO_APPS_SMMU_SMR41_2_APPS_ADDR A:0x1e008a4
y.create.l HWIO_APPS_SMMU_SMR42_2_APPS_ADDR A:0x1e008a8
y.create.l HWIO_APPS_SMMU_SMR43_2_APPS_ADDR A:0x1e008ac
y.create.l HWIO_APPS_SMMU_SMR44_2_APPS_ADDR A:0x1e008b0
y.create.l HWIO_APPS_SMMU_SMR45_2_APPS_ADDR A:0x1e008b4
y.create.l HWIO_APPS_SMMU_SMR46_2_APPS_ADDR A:0x1e008b8
y.create.l HWIO_APPS_SMMU_SMR47_2_APPS_ADDR A:0x1e008bc
y.create.l HWIO_APPS_SMMU_SMR48_2_APPS_ADDR A:0x1e008c0
y.create.l HWIO_APPS_SMMU_SMR49_2_APPS_ADDR A:0x1e008c4
y.create.l HWIO_APPS_SMMU_SMR50_2_APPS_ADDR A:0x1e008c8
y.create.l HWIO_APPS_SMMU_SMR51_2_APPS_ADDR A:0x1e008cc
y.create.l HWIO_APPS_SMMU_SMR52_2_APPS_ADDR A:0x1e008d0
y.create.l HWIO_APPS_SMMU_SMR53_2_APPS_ADDR A:0x1e008d4
y.create.l HWIO_APPS_SMMU_SMR54_2_APPS_ADDR A:0x1e008d8
y.create.l HWIO_APPS_SMMU_SMR55_2_APPS_ADDR A:0x1e008dc
y.create.l HWIO_APPS_SMMU_SMR56_2_APPS_ADDR A:0x1e008e0
y.create.l HWIO_APPS_SMMU_SMR57_2_APPS_ADDR A:0x1e008e4
y.create.l HWIO_APPS_SMMU_SMR58_2_APPS_ADDR A:0x1e008e8
y.create.l HWIO_APPS_SMMU_SMR59_2_APPS_ADDR A:0x1e008ec
y.create.l HWIO_APPS_SMMU_SMR60_2_APPS_ADDR A:0x1e008f0
y.create.l HWIO_APPS_SMMU_SMR61_2_APPS_ADDR A:0x1e008f4
y.create.l HWIO_APPS_SMMU_SMR62_2_APPS_ADDR A:0x1e008f8
y.create.l HWIO_APPS_SMMU_SMR63_2_APPS_ADDR A:0x1e008fc
y.create.l HWIO_APPS_SMMU_SMR64_2_APPS_ADDR A:0x1e00900
y.create.l HWIO_APPS_SMMU_SMR65_2_APPS_ADDR A:0x1e00904
y.create.l HWIO_APPS_SMMU_SMR66_2_APPS_ADDR A:0x1e00908
y.create.l HWIO_APPS_SMMU_SMR67_2_APPS_ADDR A:0x1e0090c
y.create.l HWIO_APPS_SMMU_SMR68_2_APPS_ADDR A:0x1e00910
y.create.l HWIO_APPS_SMMU_SMR69_2_APPS_ADDR A:0x1e00914
y.create.l HWIO_APPS_SMMU_SMR70_2_APPS_ADDR A:0x1e00918
y.create.l HWIO_APPS_SMMU_SMR71_2_APPS_ADDR A:0x1e0091c
y.create.l HWIO_APPS_SMMU_SMR72_2_APPS_ADDR A:0x1e00920
y.create.l HWIO_APPS_SMMU_SMR73_2_APPS_ADDR A:0x1e00924
y.create.l HWIO_APPS_SMMU_SMR74_2_APPS_ADDR A:0x1e00928
y.create.l HWIO_APPS_SMMU_SMR75_2_APPS_ADDR A:0x1e0092c
y.create.l HWIO_APPS_SMMU_SMR76_2_APPS_ADDR A:0x1e00930
y.create.l HWIO_APPS_SMMU_SMR77_2_APPS_ADDR A:0x1e00934
y.create.l HWIO_APPS_SMMU_SMR78_2_APPS_ADDR A:0x1e00938
y.create.l HWIO_APPS_SMMU_SMR79_2_APPS_ADDR A:0x1e0093c
y.create.l HWIO_APPS_SMMU_SMR80_2_APPS_ADDR A:0x1e00940
y.create.l HWIO_APPS_SMMU_SMR81_2_APPS_ADDR A:0x1e00944
y.create.l HWIO_APPS_SMMU_SMR82_2_APPS_ADDR A:0x1e00948
y.create.l HWIO_APPS_SMMU_SMR83_2_APPS_ADDR A:0x1e0094c
y.create.l HWIO_APPS_SMMU_SMR84_2_APPS_ADDR A:0x1e00950
y.create.l HWIO_APPS_SMMU_SMR85_2_APPS_ADDR A:0x1e00954
y.create.l HWIO_APPS_SMMU_SMR86_2_APPS_ADDR A:0x1e00958
y.create.l HWIO_APPS_SMMU_SMR87_2_APPS_ADDR A:0x1e0095c
y.create.l HWIO_APPS_SMMU_SMR88_2_APPS_ADDR A:0x1e00960
y.create.l HWIO_APPS_SMMU_SMR89_2_APPS_ADDR A:0x1e00964
y.create.l HWIO_APPS_SMMU_SMR90_2_APPS_ADDR A:0x1e00968
y.create.l HWIO_APPS_SMMU_SMR91_2_APPS_ADDR A:0x1e0096c
y.create.l HWIO_APPS_SMMU_SMR92_2_APPS_ADDR A:0x1e00970
y.create.l HWIO_APPS_SMMU_SMR93_2_APPS_ADDR A:0x1e00974
y.create.l HWIO_APPS_SMMU_SMR94_2_APPS_ADDR A:0x1e00978
y.create.l HWIO_APPS_SMMU_SMR95_2_APPS_ADDR A:0x1e0097c
y.create.l HWIO_APPS_SMMU_SMR96_2_APPS_ADDR A:0x1e00980
y.create.l HWIO_APPS_SMMU_SMR97_2_APPS_ADDR A:0x1e00984
y.create.l HWIO_APPS_SMMU_SMR98_2_APPS_ADDR A:0x1e00988
y.create.l HWIO_APPS_SMMU_SMR99_2_APPS_ADDR A:0x1e0098c
y.create.l HWIO_APPS_SMMU_SMR100_2_APPS_ADDR A:0x1e00990
y.create.l HWIO_APPS_SMMU_SMR101_2_APPS_ADDR A:0x1e00994
y.create.l HWIO_APPS_SMMU_SMR102_2_APPS_ADDR A:0x1e00998
y.create.l HWIO_APPS_SMMU_SMR103_2_APPS_ADDR A:0x1e0099c
y.create.l HWIO_APPS_SMMU_SMR104_2_APPS_ADDR A:0x1e009a0
y.create.l HWIO_APPS_SMMU_SMR105_2_APPS_ADDR A:0x1e009a4
y.create.l HWIO_APPS_SMMU_SMR106_2_APPS_ADDR A:0x1e009a8
y.create.l HWIO_APPS_SMMU_SMR107_2_APPS_ADDR A:0x1e009ac
y.create.l HWIO_APPS_SMMU_SMR108_2_APPS_ADDR A:0x1e009b0
y.create.l HWIO_APPS_SMMU_SMR109_2_APPS_ADDR A:0x1e009b4
y.create.l HWIO_APPS_SMMU_SMR110_2_APPS_ADDR A:0x1e009b8
y.create.l HWIO_APPS_SMMU_SMR111_2_APPS_ADDR A:0x1e009bc
y.create.l HWIO_APPS_SMMU_SMR112_2_APPS_ADDR A:0x1e009c0
y.create.l HWIO_APPS_SMMU_SMR113_2_APPS_ADDR A:0x1e009c4
y.create.l HWIO_APPS_SMMU_SMR114_2_APPS_ADDR A:0x1e009c8
y.create.l HWIO_APPS_SMMU_SMR115_2_APPS_ADDR A:0x1e009cc
y.create.l HWIO_APPS_SMMU_SMR116_2_APPS_ADDR A:0x1e009d0
y.create.l HWIO_APPS_SMMU_SMR117_2_APPS_ADDR A:0x1e009d4
y.create.l HWIO_APPS_SMMU_SMR118_2_APPS_ADDR A:0x1e009d8
y.create.l HWIO_APPS_SMMU_SMR119_2_APPS_ADDR A:0x1e009dc
y.create.l HWIO_APPS_SMMU_SMR120_2_APPS_ADDR A:0x1e009e0
y.create.l HWIO_APPS_SMMU_SMR121_2_APPS_ADDR A:0x1e009e4
y.create.l HWIO_APPS_SMMU_SMR122_2_APPS_ADDR A:0x1e009e8
y.create.l HWIO_APPS_SMMU_SMR123_2_APPS_ADDR A:0x1e009ec
y.create.l HWIO_APPS_SMMU_SMR124_2_APPS_ADDR A:0x1e009f0
y.create.l HWIO_APPS_SMMU_SMR125_2_APPS_ADDR A:0x1e009f4
y.create.l HWIO_APPS_SMMU_SMR126_2_APPS_ADDR A:0x1e009f8
y.create.l HWIO_APPS_SMMU_SMR127_2_APPS_ADDR A:0x1e009fc
y.create.l HWIO_APPS_SMMU_S2CR0_2_APPS_ADDR A:0x1e00c00
y.create.l HWIO_APPS_SMMU_S2CR1_2_APPS_ADDR A:0x1e00c04
y.create.l HWIO_APPS_SMMU_S2CR2_2_APPS_ADDR A:0x1e00c08
y.create.l HWIO_APPS_SMMU_S2CR3_2_APPS_ADDR A:0x1e00c0c
y.create.l HWIO_APPS_SMMU_S2CR4_2_APPS_ADDR A:0x1e00c10
y.create.l HWIO_APPS_SMMU_S2CR5_2_APPS_ADDR A:0x1e00c14
y.create.l HWIO_APPS_SMMU_S2CR6_2_APPS_ADDR A:0x1e00c18
y.create.l HWIO_APPS_SMMU_S2CR7_2_APPS_ADDR A:0x1e00c1c
y.create.l HWIO_APPS_SMMU_S2CR8_2_APPS_ADDR A:0x1e00c20
y.create.l HWIO_APPS_SMMU_S2CR9_2_APPS_ADDR A:0x1e00c24
y.create.l HWIO_APPS_SMMU_S2CR10_2_APPS_ADDR A:0x1e00c28
y.create.l HWIO_APPS_SMMU_S2CR11_2_APPS_ADDR A:0x1e00c2c
y.create.l HWIO_APPS_SMMU_S2CR12_2_APPS_ADDR A:0x1e00c30
y.create.l HWIO_APPS_SMMU_S2CR13_2_APPS_ADDR A:0x1e00c34
y.create.l HWIO_APPS_SMMU_S2CR14_2_APPS_ADDR A:0x1e00c38
y.create.l HWIO_APPS_SMMU_S2CR15_2_APPS_ADDR A:0x1e00c3c
y.create.l HWIO_APPS_SMMU_S2CR16_2_APPS_ADDR A:0x1e00c40
y.create.l HWIO_APPS_SMMU_S2CR17_2_APPS_ADDR A:0x1e00c44
y.create.l HWIO_APPS_SMMU_S2CR18_2_APPS_ADDR A:0x1e00c48
y.create.l HWIO_APPS_SMMU_S2CR19_2_APPS_ADDR A:0x1e00c4c
y.create.l HWIO_APPS_SMMU_S2CR20_2_APPS_ADDR A:0x1e00c50
y.create.l HWIO_APPS_SMMU_S2CR21_2_APPS_ADDR A:0x1e00c54
y.create.l HWIO_APPS_SMMU_S2CR22_2_APPS_ADDR A:0x1e00c58
y.create.l HWIO_APPS_SMMU_S2CR23_2_APPS_ADDR A:0x1e00c5c
y.create.l HWIO_APPS_SMMU_S2CR24_2_APPS_ADDR A:0x1e00c60
y.create.l HWIO_APPS_SMMU_S2CR25_2_APPS_ADDR A:0x1e00c64
y.create.l HWIO_APPS_SMMU_S2CR26_2_APPS_ADDR A:0x1e00c68
y.create.l HWIO_APPS_SMMU_S2CR27_2_APPS_ADDR A:0x1e00c6c
y.create.l HWIO_APPS_SMMU_S2CR28_2_APPS_ADDR A:0x1e00c70
y.create.l HWIO_APPS_SMMU_S2CR29_2_APPS_ADDR A:0x1e00c74
y.create.l HWIO_APPS_SMMU_S2CR30_2_APPS_ADDR A:0x1e00c78
y.create.l HWIO_APPS_SMMU_S2CR31_2_APPS_ADDR A:0x1e00c7c
y.create.l HWIO_APPS_SMMU_S2CR32_2_APPS_ADDR A:0x1e00c80
y.create.l HWIO_APPS_SMMU_S2CR33_2_APPS_ADDR A:0x1e00c84
y.create.l HWIO_APPS_SMMU_S2CR34_2_APPS_ADDR A:0x1e00c88
y.create.l HWIO_APPS_SMMU_S2CR35_2_APPS_ADDR A:0x1e00c8c
y.create.l HWIO_APPS_SMMU_S2CR36_2_APPS_ADDR A:0x1e00c90
y.create.l HWIO_APPS_SMMU_S2CR37_2_APPS_ADDR A:0x1e00c94
y.create.l HWIO_APPS_SMMU_S2CR38_2_APPS_ADDR A:0x1e00c98
y.create.l HWIO_APPS_SMMU_S2CR39_2_APPS_ADDR A:0x1e00c9c
y.create.l HWIO_APPS_SMMU_S2CR40_2_APPS_ADDR A:0x1e00ca0
y.create.l HWIO_APPS_SMMU_S2CR41_2_APPS_ADDR A:0x1e00ca4
y.create.l HWIO_APPS_SMMU_S2CR42_2_APPS_ADDR A:0x1e00ca8
y.create.l HWIO_APPS_SMMU_S2CR43_2_APPS_ADDR A:0x1e00cac
y.create.l HWIO_APPS_SMMU_S2CR44_2_APPS_ADDR A:0x1e00cb0
y.create.l HWIO_APPS_SMMU_S2CR45_2_APPS_ADDR A:0x1e00cb4
y.create.l HWIO_APPS_SMMU_S2CR46_2_APPS_ADDR A:0x1e00cb8
y.create.l HWIO_APPS_SMMU_S2CR47_2_APPS_ADDR A:0x1e00cbc
y.create.l HWIO_APPS_SMMU_S2CR48_2_APPS_ADDR A:0x1e00cc0
y.create.l HWIO_APPS_SMMU_S2CR49_2_APPS_ADDR A:0x1e00cc4
y.create.l HWIO_APPS_SMMU_S2CR50_2_APPS_ADDR A:0x1e00cc8
y.create.l HWIO_APPS_SMMU_S2CR51_2_APPS_ADDR A:0x1e00ccc
y.create.l HWIO_APPS_SMMU_S2CR52_2_APPS_ADDR A:0x1e00cd0
y.create.l HWIO_APPS_SMMU_S2CR53_2_APPS_ADDR A:0x1e00cd4
y.create.l HWIO_APPS_SMMU_S2CR54_2_APPS_ADDR A:0x1e00cd8
y.create.l HWIO_APPS_SMMU_S2CR55_2_APPS_ADDR A:0x1e00cdc
y.create.l HWIO_APPS_SMMU_S2CR56_2_APPS_ADDR A:0x1e00ce0
y.create.l HWIO_APPS_SMMU_S2CR57_2_APPS_ADDR A:0x1e00ce4
y.create.l HWIO_APPS_SMMU_S2CR58_2_APPS_ADDR A:0x1e00ce8
y.create.l HWIO_APPS_SMMU_S2CR59_2_APPS_ADDR A:0x1e00cec
y.create.l HWIO_APPS_SMMU_S2CR60_2_APPS_ADDR A:0x1e00cf0
y.create.l HWIO_APPS_SMMU_S2CR61_2_APPS_ADDR A:0x1e00cf4
y.create.l HWIO_APPS_SMMU_S2CR62_2_APPS_ADDR A:0x1e00cf8
y.create.l HWIO_APPS_SMMU_S2CR63_2_APPS_ADDR A:0x1e00cfc
y.create.l HWIO_APPS_SMMU_S2CR64_2_APPS_ADDR A:0x1e00d00
y.create.l HWIO_APPS_SMMU_S2CR65_2_APPS_ADDR A:0x1e00d04
y.create.l HWIO_APPS_SMMU_S2CR66_2_APPS_ADDR A:0x1e00d08
y.create.l HWIO_APPS_SMMU_S2CR67_2_APPS_ADDR A:0x1e00d0c
y.create.l HWIO_APPS_SMMU_S2CR68_2_APPS_ADDR A:0x1e00d10
y.create.l HWIO_APPS_SMMU_S2CR69_2_APPS_ADDR A:0x1e00d14
y.create.l HWIO_APPS_SMMU_S2CR70_2_APPS_ADDR A:0x1e00d18
y.create.l HWIO_APPS_SMMU_S2CR71_2_APPS_ADDR A:0x1e00d1c
y.create.l HWIO_APPS_SMMU_S2CR72_2_APPS_ADDR A:0x1e00d20
y.create.l HWIO_APPS_SMMU_S2CR73_2_APPS_ADDR A:0x1e00d24
y.create.l HWIO_APPS_SMMU_S2CR74_2_APPS_ADDR A:0x1e00d28
y.create.l HWIO_APPS_SMMU_S2CR75_2_APPS_ADDR A:0x1e00d2c
y.create.l HWIO_APPS_SMMU_S2CR76_2_APPS_ADDR A:0x1e00d30
y.create.l HWIO_APPS_SMMU_S2CR77_2_APPS_ADDR A:0x1e00d34
y.create.l HWIO_APPS_SMMU_S2CR78_2_APPS_ADDR A:0x1e00d38
y.create.l HWIO_APPS_SMMU_S2CR79_2_APPS_ADDR A:0x1e00d3c
y.create.l HWIO_APPS_SMMU_S2CR80_2_APPS_ADDR A:0x1e00d40
y.create.l HWIO_APPS_SMMU_S2CR81_2_APPS_ADDR A:0x1e00d44
y.create.l HWIO_APPS_SMMU_S2CR82_2_APPS_ADDR A:0x1e00d48
y.create.l HWIO_APPS_SMMU_S2CR83_2_APPS_ADDR A:0x1e00d4c
y.create.l HWIO_APPS_SMMU_S2CR84_2_APPS_ADDR A:0x1e00d50
y.create.l HWIO_APPS_SMMU_S2CR85_2_APPS_ADDR A:0x1e00d54
y.create.l HWIO_APPS_SMMU_S2CR86_2_APPS_ADDR A:0x1e00d58
y.create.l HWIO_APPS_SMMU_S2CR87_2_APPS_ADDR A:0x1e00d5c
y.create.l HWIO_APPS_SMMU_S2CR88_2_APPS_ADDR A:0x1e00d60
y.create.l HWIO_APPS_SMMU_S2CR89_2_APPS_ADDR A:0x1e00d64
y.create.l HWIO_APPS_SMMU_S2CR90_2_APPS_ADDR A:0x1e00d68
y.create.l HWIO_APPS_SMMU_S2CR91_2_APPS_ADDR A:0x1e00d6c
y.create.l HWIO_APPS_SMMU_S2CR92_2_APPS_ADDR A:0x1e00d70
y.create.l HWIO_APPS_SMMU_S2CR93_2_APPS_ADDR A:0x1e00d74
y.create.l HWIO_APPS_SMMU_S2CR94_2_APPS_ADDR A:0x1e00d78
y.create.l HWIO_APPS_SMMU_S2CR95_2_APPS_ADDR A:0x1e00d7c
y.create.l HWIO_APPS_SMMU_S2CR96_2_APPS_ADDR A:0x1e00d80
y.create.l HWIO_APPS_SMMU_S2CR97_2_APPS_ADDR A:0x1e00d84
y.create.l HWIO_APPS_SMMU_S2CR98_2_APPS_ADDR A:0x1e00d88
y.create.l HWIO_APPS_SMMU_S2CR99_2_APPS_ADDR A:0x1e00d8c
y.create.l HWIO_APPS_SMMU_S2CR100_2_APPS_ADDR A:0x1e00d90
y.create.l HWIO_APPS_SMMU_S2CR101_2_APPS_ADDR A:0x1e00d94
y.create.l HWIO_APPS_SMMU_S2CR102_2_APPS_ADDR A:0x1e00d98
y.create.l HWIO_APPS_SMMU_S2CR103_2_APPS_ADDR A:0x1e00d9c
y.create.l HWIO_APPS_SMMU_S2CR104_2_APPS_ADDR A:0x1e00da0
y.create.l HWIO_APPS_SMMU_S2CR105_2_APPS_ADDR A:0x1e00da4
y.create.l HWIO_APPS_SMMU_S2CR106_2_APPS_ADDR A:0x1e00da8
y.create.l HWIO_APPS_SMMU_S2CR107_2_APPS_ADDR A:0x1e00dac
y.create.l HWIO_APPS_SMMU_S2CR108_2_APPS_ADDR A:0x1e00db0
y.create.l HWIO_APPS_SMMU_S2CR109_2_APPS_ADDR A:0x1e00db4
y.create.l HWIO_APPS_SMMU_S2CR110_2_APPS_ADDR A:0x1e00db8
y.create.l HWIO_APPS_SMMU_S2CR111_2_APPS_ADDR A:0x1e00dbc
y.create.l HWIO_APPS_SMMU_S2CR112_2_APPS_ADDR A:0x1e00dc0
y.create.l HWIO_APPS_SMMU_S2CR113_2_APPS_ADDR A:0x1e00dc4
y.create.l HWIO_APPS_SMMU_S2CR114_2_APPS_ADDR A:0x1e00dc8
y.create.l HWIO_APPS_SMMU_S2CR115_2_APPS_ADDR A:0x1e00dcc
y.create.l HWIO_APPS_SMMU_S2CR116_2_APPS_ADDR A:0x1e00dd0
y.create.l HWIO_APPS_SMMU_S2CR117_2_APPS_ADDR A:0x1e00dd4
y.create.l HWIO_APPS_SMMU_S2CR118_2_APPS_ADDR A:0x1e00dd8
y.create.l HWIO_APPS_SMMU_S2CR119_2_APPS_ADDR A:0x1e00ddc
y.create.l HWIO_APPS_SMMU_S2CR120_2_APPS_ADDR A:0x1e00de0
y.create.l HWIO_APPS_SMMU_S2CR121_2_APPS_ADDR A:0x1e00de4
y.create.l HWIO_APPS_SMMU_S2CR122_2_APPS_ADDR A:0x1e00de8
y.create.l HWIO_APPS_SMMU_S2CR123_2_APPS_ADDR A:0x1e00dec
y.create.l HWIO_APPS_SMMU_S2CR124_2_APPS_ADDR A:0x1e00df0
y.create.l HWIO_APPS_SMMU_S2CR125_2_APPS_ADDR A:0x1e00df4
y.create.l HWIO_APPS_SMMU_S2CR126_2_APPS_ADDR A:0x1e00df8
y.create.l HWIO_APPS_SMMU_S2CR127_2_APPS_ADDR A:0x1e00dfc
y.create.l HWIO_APPS_SMMU_PIDR0_2_APPS_ADDR A:0x1e00fe0
y.create.l HWIO_APPS_SMMU_PIDR1_2_APPS_ADDR A:0x1e00fe4
y.create.l HWIO_APPS_SMMU_PIDR2_2_APPS_ADDR A:0x1e00fe8
y.create.l HWIO_APPS_SMMU_PIDR3_2_APPS_ADDR A:0x1e00fec
y.create.l HWIO_APPS_SMMU_PIDR4_2_APPS_ADDR A:0x1e00fd0
y.create.l HWIO_APPS_SMMU_PIDR5_2_APPS_ADDR A:0x1e00fd4
y.create.l HWIO_APPS_SMMU_PIDR6_2_APPS_ADDR A:0x1e00fd8
y.create.l HWIO_APPS_SMMU_PIDR7_2_APPS_ADDR A:0x1e00fdc
y.create.l HWIO_APPS_SMMU_CIDR0_2_APPS_ADDR A:0x1e00ff0
y.create.l HWIO_APPS_SMMU_CIDR1_2_APPS_ADDR A:0x1e00ff4
y.create.l HWIO_APPS_SMMU_CIDR2_2_APPS_ADDR A:0x1e00ff8
y.create.l HWIO_APPS_SMMU_CIDR3_2_APPS_ADDR A:0x1e00ffc
y.create.l HWIO_APPS_SMMU_CBAR0_2_APPS_ADDR A:0x1e01000
y.create.l HWIO_APPS_SMMU_CBFRSYNRA0_2_APPS_ADDR A:0x1e01400
y.create.l HWIO_APPS_SMMU_CBA2R0_2_APPS_ADDR A:0x1e01800
y.create.l HWIO_APPS_SMMU_CBAR1_2_APPS_ADDR A:0x1e01004
y.create.l HWIO_APPS_SMMU_CBFRSYNRA1_2_APPS_ADDR A:0x1e01404
y.create.l HWIO_APPS_SMMU_CBA2R1_2_APPS_ADDR A:0x1e01804
y.create.l HWIO_APPS_SMMU_CBAR2_2_APPS_ADDR A:0x1e01008
y.create.l HWIO_APPS_SMMU_CBFRSYNRA2_2_APPS_ADDR A:0x1e01408
y.create.l HWIO_APPS_SMMU_CBA2R2_2_APPS_ADDR A:0x1e01808
y.create.l HWIO_APPS_SMMU_CBAR3_2_APPS_ADDR A:0x1e0100c
y.create.l HWIO_APPS_SMMU_CBFRSYNRA3_2_APPS_ADDR A:0x1e0140c
y.create.l HWIO_APPS_SMMU_CBA2R3_2_APPS_ADDR A:0x1e0180c
y.create.l HWIO_APPS_SMMU_CBAR4_2_APPS_ADDR A:0x1e01010
y.create.l HWIO_APPS_SMMU_CBFRSYNRA4_2_APPS_ADDR A:0x1e01410
y.create.l HWIO_APPS_SMMU_CBA2R4_2_APPS_ADDR A:0x1e01810
y.create.l HWIO_APPS_SMMU_CBAR5_2_APPS_ADDR A:0x1e01014
y.create.l HWIO_APPS_SMMU_CBFRSYNRA5_2_APPS_ADDR A:0x1e01414
y.create.l HWIO_APPS_SMMU_CBA2R5_2_APPS_ADDR A:0x1e01814
y.create.l HWIO_APPS_SMMU_CBAR6_2_APPS_ADDR A:0x1e01018
y.create.l HWIO_APPS_SMMU_CBFRSYNRA6_2_APPS_ADDR A:0x1e01418
y.create.l HWIO_APPS_SMMU_CBA2R6_2_APPS_ADDR A:0x1e01818
y.create.l HWIO_APPS_SMMU_CBAR7_2_APPS_ADDR A:0x1e0101c
y.create.l HWIO_APPS_SMMU_CBFRSYNRA7_2_APPS_ADDR A:0x1e0141c
y.create.l HWIO_APPS_SMMU_CBA2R7_2_APPS_ADDR A:0x1e0181c
y.create.l HWIO_APPS_SMMU_CBAR8_2_APPS_ADDR A:0x1e01020
y.create.l HWIO_APPS_SMMU_CBFRSYNRA8_2_APPS_ADDR A:0x1e01420
y.create.l HWIO_APPS_SMMU_CBA2R8_2_APPS_ADDR A:0x1e01820
y.create.l HWIO_APPS_SMMU_CBAR9_2_APPS_ADDR A:0x1e01024
y.create.l HWIO_APPS_SMMU_CBFRSYNRA9_2_APPS_ADDR A:0x1e01424
y.create.l HWIO_APPS_SMMU_CBA2R9_2_APPS_ADDR A:0x1e01824
y.create.l HWIO_APPS_SMMU_CBAR10_2_APPS_ADDR A:0x1e01028
y.create.l HWIO_APPS_SMMU_CBFRSYNRA10_2_APPS_ADDR A:0x1e01428
y.create.l HWIO_APPS_SMMU_CBA2R10_2_APPS_ADDR A:0x1e01828
y.create.l HWIO_APPS_SMMU_CBAR11_2_APPS_ADDR A:0x1e0102c
y.create.l HWIO_APPS_SMMU_CBFRSYNRA11_2_APPS_ADDR A:0x1e0142c
y.create.l HWIO_APPS_SMMU_CBA2R11_2_APPS_ADDR A:0x1e0182c
y.create.l HWIO_APPS_SMMU_CBAR12_2_APPS_ADDR A:0x1e01030
y.create.l HWIO_APPS_SMMU_CBFRSYNRA12_2_APPS_ADDR A:0x1e01430
y.create.l HWIO_APPS_SMMU_CBA2R12_2_APPS_ADDR A:0x1e01830
y.create.l HWIO_APPS_SMMU_CBAR13_2_APPS_ADDR A:0x1e01034
y.create.l HWIO_APPS_SMMU_CBFRSYNRA13_2_APPS_ADDR A:0x1e01434
y.create.l HWIO_APPS_SMMU_CBA2R13_2_APPS_ADDR A:0x1e01834
y.create.l HWIO_APPS_SMMU_CBAR14_2_APPS_ADDR A:0x1e01038
y.create.l HWIO_APPS_SMMU_CBFRSYNRA14_2_APPS_ADDR A:0x1e01438
y.create.l HWIO_APPS_SMMU_CBA2R14_2_APPS_ADDR A:0x1e01838
y.create.l HWIO_APPS_SMMU_CBAR15_2_APPS_ADDR A:0x1e0103c
y.create.l HWIO_APPS_SMMU_CBFRSYNRA15_2_APPS_ADDR A:0x1e0143c
y.create.l HWIO_APPS_SMMU_CBA2R15_2_APPS_ADDR A:0x1e0183c
y.create.l HWIO_APPS_SMMU_CBAR16_2_APPS_ADDR A:0x1e01040
y.create.l HWIO_APPS_SMMU_CBFRSYNRA16_2_APPS_ADDR A:0x1e01440
y.create.l HWIO_APPS_SMMU_CBA2R16_2_APPS_ADDR A:0x1e01840
y.create.l HWIO_APPS_SMMU_CBAR17_2_APPS_ADDR A:0x1e01044
y.create.l HWIO_APPS_SMMU_CBFRSYNRA17_2_APPS_ADDR A:0x1e01444
y.create.l HWIO_APPS_SMMU_CBA2R17_2_APPS_ADDR A:0x1e01844
y.create.l HWIO_APPS_SMMU_CBAR18_2_APPS_ADDR A:0x1e01048
y.create.l HWIO_APPS_SMMU_CBFRSYNRA18_2_APPS_ADDR A:0x1e01448
y.create.l HWIO_APPS_SMMU_CBA2R18_2_APPS_ADDR A:0x1e01848
y.create.l HWIO_APPS_SMMU_CBAR19_2_APPS_ADDR A:0x1e0104c
y.create.l HWIO_APPS_SMMU_CBFRSYNRA19_2_APPS_ADDR A:0x1e0144c
y.create.l HWIO_APPS_SMMU_CBA2R19_2_APPS_ADDR A:0x1e0184c
y.create.l HWIO_APPS_SMMU_CBAR20_2_APPS_ADDR A:0x1e01050
y.create.l HWIO_APPS_SMMU_CBFRSYNRA20_2_APPS_ADDR A:0x1e01450
y.create.l HWIO_APPS_SMMU_CBA2R20_2_APPS_ADDR A:0x1e01850
y.create.l HWIO_APPS_SMMU_CBAR21_2_APPS_ADDR A:0x1e01054
y.create.l HWIO_APPS_SMMU_CBFRSYNRA21_2_APPS_ADDR A:0x1e01454
y.create.l HWIO_APPS_SMMU_CBA2R21_2_APPS_ADDR A:0x1e01854
y.create.l HWIO_APPS_SMMU_CBAR22_2_APPS_ADDR A:0x1e01058
y.create.l HWIO_APPS_SMMU_CBFRSYNRA22_2_APPS_ADDR A:0x1e01458
y.create.l HWIO_APPS_SMMU_CBA2R22_2_APPS_ADDR A:0x1e01858
y.create.l HWIO_APPS_SMMU_CBAR23_2_APPS_ADDR A:0x1e0105c
y.create.l HWIO_APPS_SMMU_CBFRSYNRA23_2_APPS_ADDR A:0x1e0145c
y.create.l HWIO_APPS_SMMU_CBA2R23_2_APPS_ADDR A:0x1e0185c
y.create.l HWIO_APPS_SMMU_CBAR24_2_APPS_ADDR A:0x1e01060
y.create.l HWIO_APPS_SMMU_CBFRSYNRA24_2_APPS_ADDR A:0x1e01460
y.create.l HWIO_APPS_SMMU_CBA2R24_2_APPS_ADDR A:0x1e01860
y.create.l HWIO_APPS_SMMU_CBAR25_2_APPS_ADDR A:0x1e01064
y.create.l HWIO_APPS_SMMU_CBFRSYNRA25_2_APPS_ADDR A:0x1e01464
y.create.l HWIO_APPS_SMMU_CBA2R25_2_APPS_ADDR A:0x1e01864
y.create.l HWIO_APPS_SMMU_CBAR26_2_APPS_ADDR A:0x1e01068
y.create.l HWIO_APPS_SMMU_CBFRSYNRA26_2_APPS_ADDR A:0x1e01468
y.create.l HWIO_APPS_SMMU_CBA2R26_2_APPS_ADDR A:0x1e01868
y.create.l HWIO_APPS_SMMU_CBAR27_2_APPS_ADDR A:0x1e0106c
y.create.l HWIO_APPS_SMMU_CBFRSYNRA27_2_APPS_ADDR A:0x1e0146c
y.create.l HWIO_APPS_SMMU_CBA2R27_2_APPS_ADDR A:0x1e0186c
y.create.l HWIO_APPS_SMMU_CBAR28_2_APPS_ADDR A:0x1e01070
y.create.l HWIO_APPS_SMMU_CBFRSYNRA28_2_APPS_ADDR A:0x1e01470
y.create.l HWIO_APPS_SMMU_CBA2R28_2_APPS_ADDR A:0x1e01870
y.create.l HWIO_APPS_SMMU_CBAR29_2_APPS_ADDR A:0x1e01074
y.create.l HWIO_APPS_SMMU_CBFRSYNRA29_2_APPS_ADDR A:0x1e01474
y.create.l HWIO_APPS_SMMU_CBA2R29_2_APPS_ADDR A:0x1e01874
y.create.l HWIO_APPS_SMMU_CBAR30_2_APPS_ADDR A:0x1e01078
y.create.l HWIO_APPS_SMMU_CBFRSYNRA30_2_APPS_ADDR A:0x1e01478
y.create.l HWIO_APPS_SMMU_CBA2R30_2_APPS_ADDR A:0x1e01878
y.create.l HWIO_APPS_SMMU_CBAR31_2_APPS_ADDR A:0x1e0107c
y.create.l HWIO_APPS_SMMU_CBFRSYNRA31_2_APPS_ADDR A:0x1e0147c
y.create.l HWIO_APPS_SMMU_CBA2R31_2_APPS_ADDR A:0x1e0187c
y.create.l HWIO_APPS_PMEVCNTR0_2_APPS_ADDR A:0x1e03000
y.create.l HWIO_APPS_PMEVCNTR1_2_APPS_ADDR A:0x1e03004
y.create.l HWIO_APPS_PMEVCNTR2_2_APPS_ADDR A:0x1e03008
y.create.l HWIO_APPS_PMEVCNTR3_2_APPS_ADDR A:0x1e0300c
y.create.l HWIO_APPS_PMEVTYPER0_2_APPS_ADDR A:0x1e03400
y.create.l HWIO_APPS_PMEVTYPER1_2_APPS_ADDR A:0x1e03404
y.create.l HWIO_APPS_PMEVTYPER2_2_APPS_ADDR A:0x1e03408
y.create.l HWIO_APPS_PMEVTYPER3_2_APPS_ADDR A:0x1e0340c
y.create.l HWIO_APPS_PMCGCR_2_APPS_ADDR A:0x1e03800
y.create.l HWIO_APPS_PMCGSMR_2_APPS_ADDR A:0x1e03a00
y.create.l HWIO_APPS_PMCNTENSET_2_APPS_ADDR A:0x1e03c00
y.create.l HWIO_APPS_PMCNTENCLR_2_APPS_ADDR A:0x1e03c20
y.create.l HWIO_APPS_PMINTENSET_2_APPS_ADDR A:0x1e03c40
y.create.l HWIO_APPS_PMINTENCLR_2_APPS_ADDR A:0x1e03c60
y.create.l HWIO_APPS_PMOVSCLR_2_APPS_ADDR A:0x1e03c80
y.create.l HWIO_APPS_PMOVSSET_2_APPS_ADDR A:0x1e03cc0
y.create.l HWIO_APPS_PMCFGR_2_APPS_ADDR A:0x1e03e00
y.create.l HWIO_APPS_PMCR_2_APPS_ADDR A:0x1e03e04
y.create.l HWIO_APPS_PMCEID0_2_APPS_ADDR A:0x1e03e20
y.create.l HWIO_APPS_PMAUTHSTATUS_2_APPS_ADDR A:0x1e03fb8
y.create.l HWIO_APPS_PMDEVTYPE_2_APPS_ADDR A:0x1e03fcc
y.create.l HWIO_APPS_SMMU_CB0_SCTLR_2_APPS_ADDR A:0x1e20000
y.create.l HWIO_APPS_SMMU_CB1_SCTLR_2_APPS_ADDR A:0x1e21000
y.create.l HWIO_APPS_SMMU_CB2_SCTLR_2_APPS_ADDR A:0x1e22000
y.create.l HWIO_APPS_SMMU_CB3_SCTLR_2_APPS_ADDR A:0x1e23000
y.create.l HWIO_APPS_SMMU_CB4_SCTLR_2_APPS_ADDR A:0x1e24000
y.create.l HWIO_APPS_SMMU_CB5_SCTLR_2_APPS_ADDR A:0x1e25000
y.create.l HWIO_APPS_SMMU_CB6_SCTLR_2_APPS_ADDR A:0x1e26000
y.create.l HWIO_APPS_SMMU_CB7_SCTLR_2_APPS_ADDR A:0x1e27000
y.create.l HWIO_APPS_SMMU_CB8_SCTLR_2_APPS_ADDR A:0x1e28000
y.create.l HWIO_APPS_SMMU_CB9_SCTLR_2_APPS_ADDR A:0x1e29000
y.create.l HWIO_APPS_SMMU_CB10_SCTLR_2_APPS_ADDR A:0x1e2a000
y.create.l HWIO_APPS_SMMU_CB11_SCTLR_2_APPS_ADDR A:0x1e2b000
y.create.l HWIO_APPS_SMMU_CB12_SCTLR_2_APPS_ADDR A:0x1e2c000
y.create.l HWIO_APPS_SMMU_CB13_SCTLR_2_APPS_ADDR A:0x1e2d000
y.create.l HWIO_APPS_SMMU_CB14_SCTLR_2_APPS_ADDR A:0x1e2e000
y.create.l HWIO_APPS_SMMU_CB15_SCTLR_2_APPS_ADDR A:0x1e2f000
y.create.l HWIO_APPS_SMMU_CB16_SCTLR_2_APPS_ADDR A:0x1e30000
y.create.l HWIO_APPS_SMMU_CB17_SCTLR_2_APPS_ADDR A:0x1e31000
y.create.l HWIO_APPS_SMMU_CB18_SCTLR_2_APPS_ADDR A:0x1e32000
y.create.l HWIO_APPS_SMMU_CB19_SCTLR_2_APPS_ADDR A:0x1e33000
y.create.l HWIO_APPS_SMMU_CB20_SCTLR_2_APPS_ADDR A:0x1e34000
y.create.l HWIO_APPS_SMMU_CB21_SCTLR_2_APPS_ADDR A:0x1e35000
y.create.l HWIO_APPS_SMMU_CB22_SCTLR_2_APPS_ADDR A:0x1e36000
y.create.l HWIO_APPS_SMMU_CB23_SCTLR_2_APPS_ADDR A:0x1e37000
y.create.l HWIO_APPS_SMMU_CB24_SCTLR_2_APPS_ADDR A:0x1e38000
y.create.l HWIO_APPS_SMMU_CB25_SCTLR_2_APPS_ADDR A:0x1e39000
y.create.l HWIO_APPS_SMMU_CB26_SCTLR_2_APPS_ADDR A:0x1e3a000
y.create.l HWIO_APPS_SMMU_CB27_SCTLR_2_APPS_ADDR A:0x1e3b000
y.create.l HWIO_APPS_SMMU_CB28_SCTLR_2_APPS_ADDR A:0x1e3c000
y.create.l HWIO_APPS_SMMU_CB29_SCTLR_2_APPS_ADDR A:0x1e3d000
y.create.l HWIO_APPS_SMMU_CB30_SCTLR_2_APPS_ADDR A:0x1e3e000
y.create.l HWIO_APPS_SMMU_CB31_SCTLR_2_APPS_ADDR A:0x1e3f000
y.create.l HWIO_APPS_SMMU_CB0_ACTLR_2_APPS_ADDR A:0x1e20004
y.create.l HWIO_APPS_SMMU_CB1_ACTLR_2_APPS_ADDR A:0x1e21004
y.create.l HWIO_APPS_SMMU_CB2_ACTLR_2_APPS_ADDR A:0x1e22004
y.create.l HWIO_APPS_SMMU_CB3_ACTLR_2_APPS_ADDR A:0x1e23004
y.create.l HWIO_APPS_SMMU_CB4_ACTLR_2_APPS_ADDR A:0x1e24004
y.create.l HWIO_APPS_SMMU_CB5_ACTLR_2_APPS_ADDR A:0x1e25004
y.create.l HWIO_APPS_SMMU_CB6_ACTLR_2_APPS_ADDR A:0x1e26004
y.create.l HWIO_APPS_SMMU_CB7_ACTLR_2_APPS_ADDR A:0x1e27004
y.create.l HWIO_APPS_SMMU_CB8_ACTLR_2_APPS_ADDR A:0x1e28004
y.create.l HWIO_APPS_SMMU_CB9_ACTLR_2_APPS_ADDR A:0x1e29004
y.create.l HWIO_APPS_SMMU_CB10_ACTLR_2_APPS_ADDR A:0x1e2a004
y.create.l HWIO_APPS_SMMU_CB11_ACTLR_2_APPS_ADDR A:0x1e2b004
y.create.l HWIO_APPS_SMMU_CB12_ACTLR_2_APPS_ADDR A:0x1e2c004
y.create.l HWIO_APPS_SMMU_CB13_ACTLR_2_APPS_ADDR A:0x1e2d004
y.create.l HWIO_APPS_SMMU_CB14_ACTLR_2_APPS_ADDR A:0x1e2e004
y.create.l HWIO_APPS_SMMU_CB15_ACTLR_2_APPS_ADDR A:0x1e2f004
y.create.l HWIO_APPS_SMMU_CB16_ACTLR_2_APPS_ADDR A:0x1e30004
y.create.l HWIO_APPS_SMMU_CB17_ACTLR_2_APPS_ADDR A:0x1e31004
y.create.l HWIO_APPS_SMMU_CB18_ACTLR_2_APPS_ADDR A:0x1e32004
y.create.l HWIO_APPS_SMMU_CB19_ACTLR_2_APPS_ADDR A:0x1e33004
y.create.l HWIO_APPS_SMMU_CB20_ACTLR_2_APPS_ADDR A:0x1e34004
y.create.l HWIO_APPS_SMMU_CB21_ACTLR_2_APPS_ADDR A:0x1e35004
y.create.l HWIO_APPS_SMMU_CB22_ACTLR_2_APPS_ADDR A:0x1e36004
y.create.l HWIO_APPS_SMMU_CB23_ACTLR_2_APPS_ADDR A:0x1e37004
y.create.l HWIO_APPS_SMMU_CB24_ACTLR_2_APPS_ADDR A:0x1e38004
y.create.l HWIO_APPS_SMMU_CB25_ACTLR_2_APPS_ADDR A:0x1e39004
y.create.l HWIO_APPS_SMMU_CB26_ACTLR_2_APPS_ADDR A:0x1e3a004
y.create.l HWIO_APPS_SMMU_CB27_ACTLR_2_APPS_ADDR A:0x1e3b004
y.create.l HWIO_APPS_SMMU_CB28_ACTLR_2_APPS_ADDR A:0x1e3c004
y.create.l HWIO_APPS_SMMU_CB29_ACTLR_2_APPS_ADDR A:0x1e3d004
y.create.l HWIO_APPS_SMMU_CB30_ACTLR_2_APPS_ADDR A:0x1e3e004
y.create.l HWIO_APPS_SMMU_CB31_ACTLR_2_APPS_ADDR A:0x1e3f004
y.create.l HWIO_APPS_SMMU_CB0_RESUME_2_APPS_ADDR A:0x1e20008
y.create.l HWIO_APPS_SMMU_CB1_RESUME_2_APPS_ADDR A:0x1e21008
y.create.l HWIO_APPS_SMMU_CB2_RESUME_2_APPS_ADDR A:0x1e22008
y.create.l HWIO_APPS_SMMU_CB3_RESUME_2_APPS_ADDR A:0x1e23008
y.create.l HWIO_APPS_SMMU_CB4_RESUME_2_APPS_ADDR A:0x1e24008
y.create.l HWIO_APPS_SMMU_CB5_RESUME_2_APPS_ADDR A:0x1e25008
y.create.l HWIO_APPS_SMMU_CB6_RESUME_2_APPS_ADDR A:0x1e26008
y.create.l HWIO_APPS_SMMU_CB7_RESUME_2_APPS_ADDR A:0x1e27008
y.create.l HWIO_APPS_SMMU_CB8_RESUME_2_APPS_ADDR A:0x1e28008
y.create.l HWIO_APPS_SMMU_CB9_RESUME_2_APPS_ADDR A:0x1e29008
y.create.l HWIO_APPS_SMMU_CB10_RESUME_2_APPS_ADDR A:0x1e2a008
y.create.l HWIO_APPS_SMMU_CB11_RESUME_2_APPS_ADDR A:0x1e2b008
y.create.l HWIO_APPS_SMMU_CB12_RESUME_2_APPS_ADDR A:0x1e2c008
y.create.l HWIO_APPS_SMMU_CB13_RESUME_2_APPS_ADDR A:0x1e2d008
y.create.l HWIO_APPS_SMMU_CB14_RESUME_2_APPS_ADDR A:0x1e2e008
y.create.l HWIO_APPS_SMMU_CB15_RESUME_2_APPS_ADDR A:0x1e2f008
y.create.l HWIO_APPS_SMMU_CB16_RESUME_2_APPS_ADDR A:0x1e30008
y.create.l HWIO_APPS_SMMU_CB17_RESUME_2_APPS_ADDR A:0x1e31008
y.create.l HWIO_APPS_SMMU_CB18_RESUME_2_APPS_ADDR A:0x1e32008
y.create.l HWIO_APPS_SMMU_CB19_RESUME_2_APPS_ADDR A:0x1e33008
y.create.l HWIO_APPS_SMMU_CB20_RESUME_2_APPS_ADDR A:0x1e34008
y.create.l HWIO_APPS_SMMU_CB21_RESUME_2_APPS_ADDR A:0x1e35008
y.create.l HWIO_APPS_SMMU_CB22_RESUME_2_APPS_ADDR A:0x1e36008
y.create.l HWIO_APPS_SMMU_CB23_RESUME_2_APPS_ADDR A:0x1e37008
y.create.l HWIO_APPS_SMMU_CB24_RESUME_2_APPS_ADDR A:0x1e38008
y.create.l HWIO_APPS_SMMU_CB25_RESUME_2_APPS_ADDR A:0x1e39008
y.create.l HWIO_APPS_SMMU_CB26_RESUME_2_APPS_ADDR A:0x1e3a008
y.create.l HWIO_APPS_SMMU_CB27_RESUME_2_APPS_ADDR A:0x1e3b008
y.create.l HWIO_APPS_SMMU_CB28_RESUME_2_APPS_ADDR A:0x1e3c008
y.create.l HWIO_APPS_SMMU_CB29_RESUME_2_APPS_ADDR A:0x1e3d008
y.create.l HWIO_APPS_SMMU_CB30_RESUME_2_APPS_ADDR A:0x1e3e008
y.create.l HWIO_APPS_SMMU_CB31_RESUME_2_APPS_ADDR A:0x1e3f008
y.create.l HWIO_APPS_SMMU_CB0_TCR2_2_APPS_ADDR A:0x1e20010
y.create.l HWIO_APPS_SMMU_CB1_TCR2_2_APPS_ADDR A:0x1e21010
y.create.l HWIO_APPS_SMMU_CB2_TCR2_2_APPS_ADDR A:0x1e22010
y.create.l HWIO_APPS_SMMU_CB3_TCR2_2_APPS_ADDR A:0x1e23010
y.create.l HWIO_APPS_SMMU_CB4_TCR2_2_APPS_ADDR A:0x1e24010
y.create.l HWIO_APPS_SMMU_CB5_TCR2_2_APPS_ADDR A:0x1e25010
y.create.l HWIO_APPS_SMMU_CB6_TCR2_2_APPS_ADDR A:0x1e26010
y.create.l HWIO_APPS_SMMU_CB7_TCR2_2_APPS_ADDR A:0x1e27010
y.create.l HWIO_APPS_SMMU_CB8_TCR2_2_APPS_ADDR A:0x1e28010
y.create.l HWIO_APPS_SMMU_CB9_TCR2_2_APPS_ADDR A:0x1e29010
y.create.l HWIO_APPS_SMMU_CB10_TCR2_2_APPS_ADDR A:0x1e2a010
y.create.l HWIO_APPS_SMMU_CB11_TCR2_2_APPS_ADDR A:0x1e2b010
y.create.l HWIO_APPS_SMMU_CB12_TCR2_2_APPS_ADDR A:0x1e2c010
y.create.l HWIO_APPS_SMMU_CB13_TCR2_2_APPS_ADDR A:0x1e2d010
y.create.l HWIO_APPS_SMMU_CB14_TCR2_2_APPS_ADDR A:0x1e2e010
y.create.l HWIO_APPS_SMMU_CB15_TCR2_2_APPS_ADDR A:0x1e2f010
y.create.l HWIO_APPS_SMMU_CB16_TCR2_2_APPS_ADDR A:0x1e30010
y.create.l HWIO_APPS_SMMU_CB17_TCR2_2_APPS_ADDR A:0x1e31010
y.create.l HWIO_APPS_SMMU_CB18_TCR2_2_APPS_ADDR A:0x1e32010
y.create.l HWIO_APPS_SMMU_CB19_TCR2_2_APPS_ADDR A:0x1e33010
y.create.l HWIO_APPS_SMMU_CB20_TCR2_2_APPS_ADDR A:0x1e34010
y.create.l HWIO_APPS_SMMU_CB21_TCR2_2_APPS_ADDR A:0x1e35010
y.create.l HWIO_APPS_SMMU_CB22_TCR2_2_APPS_ADDR A:0x1e36010
y.create.l HWIO_APPS_SMMU_CB23_TCR2_2_APPS_ADDR A:0x1e37010
y.create.l HWIO_APPS_SMMU_CB24_TCR2_2_APPS_ADDR A:0x1e38010
y.create.l HWIO_APPS_SMMU_CB25_TCR2_2_APPS_ADDR A:0x1e39010
y.create.l HWIO_APPS_SMMU_CB26_TCR2_2_APPS_ADDR A:0x1e3a010
y.create.l HWIO_APPS_SMMU_CB27_TCR2_2_APPS_ADDR A:0x1e3b010
y.create.l HWIO_APPS_SMMU_CB28_TCR2_2_APPS_ADDR A:0x1e3c010
y.create.l HWIO_APPS_SMMU_CB29_TCR2_2_APPS_ADDR A:0x1e3d010
y.create.l HWIO_APPS_SMMU_CB30_TCR2_2_APPS_ADDR A:0x1e3e010
y.create.l HWIO_APPS_SMMU_CB31_TCR2_2_APPS_ADDR A:0x1e3f010
y.create.l HWIO_APPS_SMMU_CB0_TTBR0_LOW_2_APPS_ADDR A:0x1e20020
y.create.l HWIO_APPS_SMMU_CB1_TTBR0_LOW_2_APPS_ADDR A:0x1e21020
y.create.l HWIO_APPS_SMMU_CB2_TTBR0_LOW_2_APPS_ADDR A:0x1e22020
y.create.l HWIO_APPS_SMMU_CB3_TTBR0_LOW_2_APPS_ADDR A:0x1e23020
y.create.l HWIO_APPS_SMMU_CB4_TTBR0_LOW_2_APPS_ADDR A:0x1e24020
y.create.l HWIO_APPS_SMMU_CB5_TTBR0_LOW_2_APPS_ADDR A:0x1e25020
y.create.l HWIO_APPS_SMMU_CB6_TTBR0_LOW_2_APPS_ADDR A:0x1e26020
y.create.l HWIO_APPS_SMMU_CB7_TTBR0_LOW_2_APPS_ADDR A:0x1e27020
y.create.l HWIO_APPS_SMMU_CB8_TTBR0_LOW_2_APPS_ADDR A:0x1e28020
y.create.l HWIO_APPS_SMMU_CB9_TTBR0_LOW_2_APPS_ADDR A:0x1e29020
y.create.l HWIO_APPS_SMMU_CB10_TTBR0_LOW_2_APPS_ADDR A:0x1e2a020
y.create.l HWIO_APPS_SMMU_CB11_TTBR0_LOW_2_APPS_ADDR A:0x1e2b020
y.create.l HWIO_APPS_SMMU_CB12_TTBR0_LOW_2_APPS_ADDR A:0x1e2c020
y.create.l HWIO_APPS_SMMU_CB13_TTBR0_LOW_2_APPS_ADDR A:0x1e2d020
y.create.l HWIO_APPS_SMMU_CB14_TTBR0_LOW_2_APPS_ADDR A:0x1e2e020
y.create.l HWIO_APPS_SMMU_CB15_TTBR0_LOW_2_APPS_ADDR A:0x1e2f020
y.create.l HWIO_APPS_SMMU_CB16_TTBR0_LOW_2_APPS_ADDR A:0x1e30020
y.create.l HWIO_APPS_SMMU_CB17_TTBR0_LOW_2_APPS_ADDR A:0x1e31020
y.create.l HWIO_APPS_SMMU_CB18_TTBR0_LOW_2_APPS_ADDR A:0x1e32020
y.create.l HWIO_APPS_SMMU_CB19_TTBR0_LOW_2_APPS_ADDR A:0x1e33020
y.create.l HWIO_APPS_SMMU_CB20_TTBR0_LOW_2_APPS_ADDR A:0x1e34020
y.create.l HWIO_APPS_SMMU_CB21_TTBR0_LOW_2_APPS_ADDR A:0x1e35020
y.create.l HWIO_APPS_SMMU_CB22_TTBR0_LOW_2_APPS_ADDR A:0x1e36020
y.create.l HWIO_APPS_SMMU_CB23_TTBR0_LOW_2_APPS_ADDR A:0x1e37020
y.create.l HWIO_APPS_SMMU_CB24_TTBR0_LOW_2_APPS_ADDR A:0x1e38020
y.create.l HWIO_APPS_SMMU_CB25_TTBR0_LOW_2_APPS_ADDR A:0x1e39020
y.create.l HWIO_APPS_SMMU_CB26_TTBR0_LOW_2_APPS_ADDR A:0x1e3a020
y.create.l HWIO_APPS_SMMU_CB27_TTBR0_LOW_2_APPS_ADDR A:0x1e3b020
y.create.l HWIO_APPS_SMMU_CB28_TTBR0_LOW_2_APPS_ADDR A:0x1e3c020
y.create.l HWIO_APPS_SMMU_CB29_TTBR0_LOW_2_APPS_ADDR A:0x1e3d020
y.create.l HWIO_APPS_SMMU_CB30_TTBR0_LOW_2_APPS_ADDR A:0x1e3e020
y.create.l HWIO_APPS_SMMU_CB31_TTBR0_LOW_2_APPS_ADDR A:0x1e3f020
y.create.l HWIO_APPS_SMMU_CB0_TTBR0_HIGH_2_APPS_ADDR A:0x1e20024
y.create.l HWIO_APPS_SMMU_CB1_TTBR0_HIGH_2_APPS_ADDR A:0x1e21024
y.create.l HWIO_APPS_SMMU_CB2_TTBR0_HIGH_2_APPS_ADDR A:0x1e22024
y.create.l HWIO_APPS_SMMU_CB3_TTBR0_HIGH_2_APPS_ADDR A:0x1e23024
y.create.l HWIO_APPS_SMMU_CB4_TTBR0_HIGH_2_APPS_ADDR A:0x1e24024
y.create.l HWIO_APPS_SMMU_CB5_TTBR0_HIGH_2_APPS_ADDR A:0x1e25024
y.create.l HWIO_APPS_SMMU_CB6_TTBR0_HIGH_2_APPS_ADDR A:0x1e26024
y.create.l HWIO_APPS_SMMU_CB7_TTBR0_HIGH_2_APPS_ADDR A:0x1e27024
y.create.l HWIO_APPS_SMMU_CB8_TTBR0_HIGH_2_APPS_ADDR A:0x1e28024
y.create.l HWIO_APPS_SMMU_CB9_TTBR0_HIGH_2_APPS_ADDR A:0x1e29024
y.create.l HWIO_APPS_SMMU_CB10_TTBR0_HIGH_2_APPS_ADDR A:0x1e2a024
y.create.l HWIO_APPS_SMMU_CB11_TTBR0_HIGH_2_APPS_ADDR A:0x1e2b024
y.create.l HWIO_APPS_SMMU_CB12_TTBR0_HIGH_2_APPS_ADDR A:0x1e2c024
y.create.l HWIO_APPS_SMMU_CB13_TTBR0_HIGH_2_APPS_ADDR A:0x1e2d024
y.create.l HWIO_APPS_SMMU_CB14_TTBR0_HIGH_2_APPS_ADDR A:0x1e2e024
y.create.l HWIO_APPS_SMMU_CB15_TTBR0_HIGH_2_APPS_ADDR A:0x1e2f024
y.create.l HWIO_APPS_SMMU_CB16_TTBR0_HIGH_2_APPS_ADDR A:0x1e30024
y.create.l HWIO_APPS_SMMU_CB17_TTBR0_HIGH_2_APPS_ADDR A:0x1e31024
y.create.l HWIO_APPS_SMMU_CB18_TTBR0_HIGH_2_APPS_ADDR A:0x1e32024
y.create.l HWIO_APPS_SMMU_CB19_TTBR0_HIGH_2_APPS_ADDR A:0x1e33024
y.create.l HWIO_APPS_SMMU_CB20_TTBR0_HIGH_2_APPS_ADDR A:0x1e34024
y.create.l HWIO_APPS_SMMU_CB21_TTBR0_HIGH_2_APPS_ADDR A:0x1e35024
y.create.l HWIO_APPS_SMMU_CB22_TTBR0_HIGH_2_APPS_ADDR A:0x1e36024
y.create.l HWIO_APPS_SMMU_CB23_TTBR0_HIGH_2_APPS_ADDR A:0x1e37024
y.create.l HWIO_APPS_SMMU_CB24_TTBR0_HIGH_2_APPS_ADDR A:0x1e38024
y.create.l HWIO_APPS_SMMU_CB25_TTBR0_HIGH_2_APPS_ADDR A:0x1e39024
y.create.l HWIO_APPS_SMMU_CB26_TTBR0_HIGH_2_APPS_ADDR A:0x1e3a024
y.create.l HWIO_APPS_SMMU_CB27_TTBR0_HIGH_2_APPS_ADDR A:0x1e3b024
y.create.l HWIO_APPS_SMMU_CB28_TTBR0_HIGH_2_APPS_ADDR A:0x1e3c024
y.create.l HWIO_APPS_SMMU_CB29_TTBR0_HIGH_2_APPS_ADDR A:0x1e3d024
y.create.l HWIO_APPS_SMMU_CB30_TTBR0_HIGH_2_APPS_ADDR A:0x1e3e024
y.create.l HWIO_APPS_SMMU_CB31_TTBR0_HIGH_2_APPS_ADDR A:0x1e3f024
y.create.l HWIO_APPS_SMMU_CB0_TTBR1_LOW_2_APPS_ADDR A:0x1e20028
y.create.l HWIO_APPS_SMMU_CB1_TTBR1_LOW_2_APPS_ADDR A:0x1e21028
y.create.l HWIO_APPS_SMMU_CB2_TTBR1_LOW_2_APPS_ADDR A:0x1e22028
y.create.l HWIO_APPS_SMMU_CB3_TTBR1_LOW_2_APPS_ADDR A:0x1e23028
y.create.l HWIO_APPS_SMMU_CB4_TTBR1_LOW_2_APPS_ADDR A:0x1e24028
y.create.l HWIO_APPS_SMMU_CB5_TTBR1_LOW_2_APPS_ADDR A:0x1e25028
y.create.l HWIO_APPS_SMMU_CB6_TTBR1_LOW_2_APPS_ADDR A:0x1e26028
y.create.l HWIO_APPS_SMMU_CB7_TTBR1_LOW_2_APPS_ADDR A:0x1e27028
y.create.l HWIO_APPS_SMMU_CB8_TTBR1_LOW_2_APPS_ADDR A:0x1e28028
y.create.l HWIO_APPS_SMMU_CB9_TTBR1_LOW_2_APPS_ADDR A:0x1e29028
y.create.l HWIO_APPS_SMMU_CB10_TTBR1_LOW_2_APPS_ADDR A:0x1e2a028
y.create.l HWIO_APPS_SMMU_CB11_TTBR1_LOW_2_APPS_ADDR A:0x1e2b028
y.create.l HWIO_APPS_SMMU_CB12_TTBR1_LOW_2_APPS_ADDR A:0x1e2c028
y.create.l HWIO_APPS_SMMU_CB13_TTBR1_LOW_2_APPS_ADDR A:0x1e2d028
y.create.l HWIO_APPS_SMMU_CB14_TTBR1_LOW_2_APPS_ADDR A:0x1e2e028
y.create.l HWIO_APPS_SMMU_CB15_TTBR1_LOW_2_APPS_ADDR A:0x1e2f028
y.create.l HWIO_APPS_SMMU_CB16_TTBR1_LOW_2_APPS_ADDR A:0x1e30028
y.create.l HWIO_APPS_SMMU_CB17_TTBR1_LOW_2_APPS_ADDR A:0x1e31028
y.create.l HWIO_APPS_SMMU_CB18_TTBR1_LOW_2_APPS_ADDR A:0x1e32028
y.create.l HWIO_APPS_SMMU_CB19_TTBR1_LOW_2_APPS_ADDR A:0x1e33028
y.create.l HWIO_APPS_SMMU_CB20_TTBR1_LOW_2_APPS_ADDR A:0x1e34028
y.create.l HWIO_APPS_SMMU_CB21_TTBR1_LOW_2_APPS_ADDR A:0x1e35028
y.create.l HWIO_APPS_SMMU_CB22_TTBR1_LOW_2_APPS_ADDR A:0x1e36028
y.create.l HWIO_APPS_SMMU_CB23_TTBR1_LOW_2_APPS_ADDR A:0x1e37028
y.create.l HWIO_APPS_SMMU_CB24_TTBR1_LOW_2_APPS_ADDR A:0x1e38028
y.create.l HWIO_APPS_SMMU_CB25_TTBR1_LOW_2_APPS_ADDR A:0x1e39028
y.create.l HWIO_APPS_SMMU_CB26_TTBR1_LOW_2_APPS_ADDR A:0x1e3a028
y.create.l HWIO_APPS_SMMU_CB27_TTBR1_LOW_2_APPS_ADDR A:0x1e3b028
y.create.l HWIO_APPS_SMMU_CB28_TTBR1_LOW_2_APPS_ADDR A:0x1e3c028
y.create.l HWIO_APPS_SMMU_CB29_TTBR1_LOW_2_APPS_ADDR A:0x1e3d028
y.create.l HWIO_APPS_SMMU_CB30_TTBR1_LOW_2_APPS_ADDR A:0x1e3e028
y.create.l HWIO_APPS_SMMU_CB31_TTBR1_LOW_2_APPS_ADDR A:0x1e3f028
y.create.l HWIO_APPS_SMMU_CB0_TTBR1_HIGH_2_APPS_ADDR A:0x1e2002c
y.create.l HWIO_APPS_SMMU_CB1_TTBR1_HIGH_2_APPS_ADDR A:0x1e2102c
y.create.l HWIO_APPS_SMMU_CB2_TTBR1_HIGH_2_APPS_ADDR A:0x1e2202c
y.create.l HWIO_APPS_SMMU_CB3_TTBR1_HIGH_2_APPS_ADDR A:0x1e2302c
y.create.l HWIO_APPS_SMMU_CB4_TTBR1_HIGH_2_APPS_ADDR A:0x1e2402c
y.create.l HWIO_APPS_SMMU_CB5_TTBR1_HIGH_2_APPS_ADDR A:0x1e2502c
y.create.l HWIO_APPS_SMMU_CB6_TTBR1_HIGH_2_APPS_ADDR A:0x1e2602c
y.create.l HWIO_APPS_SMMU_CB7_TTBR1_HIGH_2_APPS_ADDR A:0x1e2702c
y.create.l HWIO_APPS_SMMU_CB8_TTBR1_HIGH_2_APPS_ADDR A:0x1e2802c
y.create.l HWIO_APPS_SMMU_CB9_TTBR1_HIGH_2_APPS_ADDR A:0x1e2902c
y.create.l HWIO_APPS_SMMU_CB10_TTBR1_HIGH_2_APPS_ADDR A:0x1e2a02c
y.create.l HWIO_APPS_SMMU_CB11_TTBR1_HIGH_2_APPS_ADDR A:0x1e2b02c
y.create.l HWIO_APPS_SMMU_CB12_TTBR1_HIGH_2_APPS_ADDR A:0x1e2c02c
y.create.l HWIO_APPS_SMMU_CB13_TTBR1_HIGH_2_APPS_ADDR A:0x1e2d02c
y.create.l HWIO_APPS_SMMU_CB14_TTBR1_HIGH_2_APPS_ADDR A:0x1e2e02c
y.create.l HWIO_APPS_SMMU_CB15_TTBR1_HIGH_2_APPS_ADDR A:0x1e2f02c
y.create.l HWIO_APPS_SMMU_CB16_TTBR1_HIGH_2_APPS_ADDR A:0x1e3002c
y.create.l HWIO_APPS_SMMU_CB17_TTBR1_HIGH_2_APPS_ADDR A:0x1e3102c
y.create.l HWIO_APPS_SMMU_CB18_TTBR1_HIGH_2_APPS_ADDR A:0x1e3202c
y.create.l HWIO_APPS_SMMU_CB19_TTBR1_HIGH_2_APPS_ADDR A:0x1e3302c
y.create.l HWIO_APPS_SMMU_CB20_TTBR1_HIGH_2_APPS_ADDR A:0x1e3402c
y.create.l HWIO_APPS_SMMU_CB21_TTBR1_HIGH_2_APPS_ADDR A:0x1e3502c
y.create.l HWIO_APPS_SMMU_CB22_TTBR1_HIGH_2_APPS_ADDR A:0x1e3602c
y.create.l HWIO_APPS_SMMU_CB23_TTBR1_HIGH_2_APPS_ADDR A:0x1e3702c
y.create.l HWIO_APPS_SMMU_CB24_TTBR1_HIGH_2_APPS_ADDR A:0x1e3802c
y.create.l HWIO_APPS_SMMU_CB25_TTBR1_HIGH_2_APPS_ADDR A:0x1e3902c
y.create.l HWIO_APPS_SMMU_CB26_TTBR1_HIGH_2_APPS_ADDR A:0x1e3a02c
y.create.l HWIO_APPS_SMMU_CB27_TTBR1_HIGH_2_APPS_ADDR A:0x1e3b02c
y.create.l HWIO_APPS_SMMU_CB28_TTBR1_HIGH_2_APPS_ADDR A:0x1e3c02c
y.create.l HWIO_APPS_SMMU_CB29_TTBR1_HIGH_2_APPS_ADDR A:0x1e3d02c
y.create.l HWIO_APPS_SMMU_CB30_TTBR1_HIGH_2_APPS_ADDR A:0x1e3e02c
y.create.l HWIO_APPS_SMMU_CB31_TTBR1_HIGH_2_APPS_ADDR A:0x1e3f02c
y.create.l HWIO_APPS_SMMU_CB0_TCR_LPAE_2_APPS_ADDR A:0x1e20030
y.create.l HWIO_APPS_SMMU_CB1_TCR_LPAE_2_APPS_ADDR A:0x1e21030
y.create.l HWIO_APPS_SMMU_CB2_TCR_LPAE_2_APPS_ADDR A:0x1e22030
y.create.l HWIO_APPS_SMMU_CB3_TCR_LPAE_2_APPS_ADDR A:0x1e23030
y.create.l HWIO_APPS_SMMU_CB4_TCR_LPAE_2_APPS_ADDR A:0x1e24030
y.create.l HWIO_APPS_SMMU_CB5_TCR_LPAE_2_APPS_ADDR A:0x1e25030
y.create.l HWIO_APPS_SMMU_CB6_TCR_LPAE_2_APPS_ADDR A:0x1e26030
y.create.l HWIO_APPS_SMMU_CB7_TCR_LPAE_2_APPS_ADDR A:0x1e27030
y.create.l HWIO_APPS_SMMU_CB8_TCR_LPAE_2_APPS_ADDR A:0x1e28030
y.create.l HWIO_APPS_SMMU_CB9_TCR_LPAE_2_APPS_ADDR A:0x1e29030
y.create.l HWIO_APPS_SMMU_CB10_TCR_LPAE_2_APPS_ADDR A:0x1e2a030
y.create.l HWIO_APPS_SMMU_CB11_TCR_LPAE_2_APPS_ADDR A:0x1e2b030
y.create.l HWIO_APPS_SMMU_CB12_TCR_LPAE_2_APPS_ADDR A:0x1e2c030
y.create.l HWIO_APPS_SMMU_CB13_TCR_LPAE_2_APPS_ADDR A:0x1e2d030
y.create.l HWIO_APPS_SMMU_CB14_TCR_LPAE_2_APPS_ADDR A:0x1e2e030
y.create.l HWIO_APPS_SMMU_CB15_TCR_LPAE_2_APPS_ADDR A:0x1e2f030
y.create.l HWIO_APPS_SMMU_CB16_TCR_LPAE_2_APPS_ADDR A:0x1e30030
y.create.l HWIO_APPS_SMMU_CB17_TCR_LPAE_2_APPS_ADDR A:0x1e31030
y.create.l HWIO_APPS_SMMU_CB18_TCR_LPAE_2_APPS_ADDR A:0x1e32030
y.create.l HWIO_APPS_SMMU_CB19_TCR_LPAE_2_APPS_ADDR A:0x1e33030
y.create.l HWIO_APPS_SMMU_CB20_TCR_LPAE_2_APPS_ADDR A:0x1e34030
y.create.l HWIO_APPS_SMMU_CB21_TCR_LPAE_2_APPS_ADDR A:0x1e35030
y.create.l HWIO_APPS_SMMU_CB22_TCR_LPAE_2_APPS_ADDR A:0x1e36030
y.create.l HWIO_APPS_SMMU_CB23_TCR_LPAE_2_APPS_ADDR A:0x1e37030
y.create.l HWIO_APPS_SMMU_CB24_TCR_LPAE_2_APPS_ADDR A:0x1e38030
y.create.l HWIO_APPS_SMMU_CB25_TCR_LPAE_2_APPS_ADDR A:0x1e39030
y.create.l HWIO_APPS_SMMU_CB26_TCR_LPAE_2_APPS_ADDR A:0x1e3a030
y.create.l HWIO_APPS_SMMU_CB27_TCR_LPAE_2_APPS_ADDR A:0x1e3b030
y.create.l HWIO_APPS_SMMU_CB28_TCR_LPAE_2_APPS_ADDR A:0x1e3c030
y.create.l HWIO_APPS_SMMU_CB29_TCR_LPAE_2_APPS_ADDR A:0x1e3d030
y.create.l HWIO_APPS_SMMU_CB30_TCR_LPAE_2_APPS_ADDR A:0x1e3e030
y.create.l HWIO_APPS_SMMU_CB31_TCR_LPAE_2_APPS_ADDR A:0x1e3f030
y.create.l HWIO_APPS_SMMU_CB0_CONTEXTIDR_2_APPS_ADDR A:0x1e20034
y.create.l HWIO_APPS_SMMU_CB1_CONTEXTIDR_2_APPS_ADDR A:0x1e21034
y.create.l HWIO_APPS_SMMU_CB2_CONTEXTIDR_2_APPS_ADDR A:0x1e22034
y.create.l HWIO_APPS_SMMU_CB3_CONTEXTIDR_2_APPS_ADDR A:0x1e23034
y.create.l HWIO_APPS_SMMU_CB4_CONTEXTIDR_2_APPS_ADDR A:0x1e24034
y.create.l HWIO_APPS_SMMU_CB5_CONTEXTIDR_2_APPS_ADDR A:0x1e25034
y.create.l HWIO_APPS_SMMU_CB6_CONTEXTIDR_2_APPS_ADDR A:0x1e26034
y.create.l HWIO_APPS_SMMU_CB7_CONTEXTIDR_2_APPS_ADDR A:0x1e27034
y.create.l HWIO_APPS_SMMU_CB8_CONTEXTIDR_2_APPS_ADDR A:0x1e28034
y.create.l HWIO_APPS_SMMU_CB9_CONTEXTIDR_2_APPS_ADDR A:0x1e29034
y.create.l HWIO_APPS_SMMU_CB10_CONTEXTIDR_2_APPS_ADDR A:0x1e2a034
y.create.l HWIO_APPS_SMMU_CB11_CONTEXTIDR_2_APPS_ADDR A:0x1e2b034
y.create.l HWIO_APPS_SMMU_CB12_CONTEXTIDR_2_APPS_ADDR A:0x1e2c034
y.create.l HWIO_APPS_SMMU_CB13_CONTEXTIDR_2_APPS_ADDR A:0x1e2d034
y.create.l HWIO_APPS_SMMU_CB14_CONTEXTIDR_2_APPS_ADDR A:0x1e2e034
y.create.l HWIO_APPS_SMMU_CB15_CONTEXTIDR_2_APPS_ADDR A:0x1e2f034
y.create.l HWIO_APPS_SMMU_CB16_CONTEXTIDR_2_APPS_ADDR A:0x1e30034
y.create.l HWIO_APPS_SMMU_CB17_CONTEXTIDR_2_APPS_ADDR A:0x1e31034
y.create.l HWIO_APPS_SMMU_CB18_CONTEXTIDR_2_APPS_ADDR A:0x1e32034
y.create.l HWIO_APPS_SMMU_CB19_CONTEXTIDR_2_APPS_ADDR A:0x1e33034
y.create.l HWIO_APPS_SMMU_CB20_CONTEXTIDR_2_APPS_ADDR A:0x1e34034
y.create.l HWIO_APPS_SMMU_CB21_CONTEXTIDR_2_APPS_ADDR A:0x1e35034
y.create.l HWIO_APPS_SMMU_CB22_CONTEXTIDR_2_APPS_ADDR A:0x1e36034
y.create.l HWIO_APPS_SMMU_CB23_CONTEXTIDR_2_APPS_ADDR A:0x1e37034
y.create.l HWIO_APPS_SMMU_CB24_CONTEXTIDR_2_APPS_ADDR A:0x1e38034
y.create.l HWIO_APPS_SMMU_CB25_CONTEXTIDR_2_APPS_ADDR A:0x1e39034
y.create.l HWIO_APPS_SMMU_CB26_CONTEXTIDR_2_APPS_ADDR A:0x1e3a034
y.create.l HWIO_APPS_SMMU_CB27_CONTEXTIDR_2_APPS_ADDR A:0x1e3b034
y.create.l HWIO_APPS_SMMU_CB28_CONTEXTIDR_2_APPS_ADDR A:0x1e3c034
y.create.l HWIO_APPS_SMMU_CB29_CONTEXTIDR_2_APPS_ADDR A:0x1e3d034
y.create.l HWIO_APPS_SMMU_CB30_CONTEXTIDR_2_APPS_ADDR A:0x1e3e034
y.create.l HWIO_APPS_SMMU_CB31_CONTEXTIDR_2_APPS_ADDR A:0x1e3f034
y.create.l HWIO_APPS_SMMU_CB0_PRRR_MAIR0_2_APPS_ADDR A:0x1e20038
y.create.l HWIO_APPS_SMMU_CB1_PRRR_MAIR0_2_APPS_ADDR A:0x1e21038
y.create.l HWIO_APPS_SMMU_CB2_PRRR_MAIR0_2_APPS_ADDR A:0x1e22038
y.create.l HWIO_APPS_SMMU_CB3_PRRR_MAIR0_2_APPS_ADDR A:0x1e23038
y.create.l HWIO_APPS_SMMU_CB4_PRRR_MAIR0_2_APPS_ADDR A:0x1e24038
y.create.l HWIO_APPS_SMMU_CB5_PRRR_MAIR0_2_APPS_ADDR A:0x1e25038
y.create.l HWIO_APPS_SMMU_CB6_PRRR_MAIR0_2_APPS_ADDR A:0x1e26038
y.create.l HWIO_APPS_SMMU_CB7_PRRR_MAIR0_2_APPS_ADDR A:0x1e27038
y.create.l HWIO_APPS_SMMU_CB8_PRRR_MAIR0_2_APPS_ADDR A:0x1e28038
y.create.l HWIO_APPS_SMMU_CB9_PRRR_MAIR0_2_APPS_ADDR A:0x1e29038
y.create.l HWIO_APPS_SMMU_CB10_PRRR_MAIR0_2_APPS_ADDR A:0x1e2a038
y.create.l HWIO_APPS_SMMU_CB11_PRRR_MAIR0_2_APPS_ADDR A:0x1e2b038
y.create.l HWIO_APPS_SMMU_CB12_PRRR_MAIR0_2_APPS_ADDR A:0x1e2c038
y.create.l HWIO_APPS_SMMU_CB13_PRRR_MAIR0_2_APPS_ADDR A:0x1e2d038
y.create.l HWIO_APPS_SMMU_CB14_PRRR_MAIR0_2_APPS_ADDR A:0x1e2e038
y.create.l HWIO_APPS_SMMU_CB15_PRRR_MAIR0_2_APPS_ADDR A:0x1e2f038
y.create.l HWIO_APPS_SMMU_CB16_PRRR_MAIR0_2_APPS_ADDR A:0x1e30038
y.create.l HWIO_APPS_SMMU_CB17_PRRR_MAIR0_2_APPS_ADDR A:0x1e31038
y.create.l HWIO_APPS_SMMU_CB18_PRRR_MAIR0_2_APPS_ADDR A:0x1e32038
y.create.l HWIO_APPS_SMMU_CB19_PRRR_MAIR0_2_APPS_ADDR A:0x1e33038
y.create.l HWIO_APPS_SMMU_CB20_PRRR_MAIR0_2_APPS_ADDR A:0x1e34038
y.create.l HWIO_APPS_SMMU_CB21_PRRR_MAIR0_2_APPS_ADDR A:0x1e35038
y.create.l HWIO_APPS_SMMU_CB22_PRRR_MAIR0_2_APPS_ADDR A:0x1e36038
y.create.l HWIO_APPS_SMMU_CB23_PRRR_MAIR0_2_APPS_ADDR A:0x1e37038
y.create.l HWIO_APPS_SMMU_CB24_PRRR_MAIR0_2_APPS_ADDR A:0x1e38038
y.create.l HWIO_APPS_SMMU_CB25_PRRR_MAIR0_2_APPS_ADDR A:0x1e39038
y.create.l HWIO_APPS_SMMU_CB26_PRRR_MAIR0_2_APPS_ADDR A:0x1e3a038
y.create.l HWIO_APPS_SMMU_CB27_PRRR_MAIR0_2_APPS_ADDR A:0x1e3b038
y.create.l HWIO_APPS_SMMU_CB28_PRRR_MAIR0_2_APPS_ADDR A:0x1e3c038
y.create.l HWIO_APPS_SMMU_CB29_PRRR_MAIR0_2_APPS_ADDR A:0x1e3d038
y.create.l HWIO_APPS_SMMU_CB30_PRRR_MAIR0_2_APPS_ADDR A:0x1e3e038
y.create.l HWIO_APPS_SMMU_CB31_PRRR_MAIR0_2_APPS_ADDR A:0x1e3f038
y.create.l HWIO_APPS_SMMU_CB0_NMRR_MAIR1_2_APPS_ADDR A:0x1e2003c
y.create.l HWIO_APPS_SMMU_CB1_NMRR_MAIR1_2_APPS_ADDR A:0x1e2103c
y.create.l HWIO_APPS_SMMU_CB2_NMRR_MAIR1_2_APPS_ADDR A:0x1e2203c
y.create.l HWIO_APPS_SMMU_CB3_NMRR_MAIR1_2_APPS_ADDR A:0x1e2303c
y.create.l HWIO_APPS_SMMU_CB4_NMRR_MAIR1_2_APPS_ADDR A:0x1e2403c
y.create.l HWIO_APPS_SMMU_CB5_NMRR_MAIR1_2_APPS_ADDR A:0x1e2503c
y.create.l HWIO_APPS_SMMU_CB6_NMRR_MAIR1_2_APPS_ADDR A:0x1e2603c
y.create.l HWIO_APPS_SMMU_CB7_NMRR_MAIR1_2_APPS_ADDR A:0x1e2703c
y.create.l HWIO_APPS_SMMU_CB8_NMRR_MAIR1_2_APPS_ADDR A:0x1e2803c
y.create.l HWIO_APPS_SMMU_CB9_NMRR_MAIR1_2_APPS_ADDR A:0x1e2903c
y.create.l HWIO_APPS_SMMU_CB10_NMRR_MAIR1_2_APPS_ADDR A:0x1e2a03c
y.create.l HWIO_APPS_SMMU_CB11_NMRR_MAIR1_2_APPS_ADDR A:0x1e2b03c
y.create.l HWIO_APPS_SMMU_CB12_NMRR_MAIR1_2_APPS_ADDR A:0x1e2c03c
y.create.l HWIO_APPS_SMMU_CB13_NMRR_MAIR1_2_APPS_ADDR A:0x1e2d03c
y.create.l HWIO_APPS_SMMU_CB14_NMRR_MAIR1_2_APPS_ADDR A:0x1e2e03c
y.create.l HWIO_APPS_SMMU_CB15_NMRR_MAIR1_2_APPS_ADDR A:0x1e2f03c
y.create.l HWIO_APPS_SMMU_CB16_NMRR_MAIR1_2_APPS_ADDR A:0x1e3003c
y.create.l HWIO_APPS_SMMU_CB17_NMRR_MAIR1_2_APPS_ADDR A:0x1e3103c
y.create.l HWIO_APPS_SMMU_CB18_NMRR_MAIR1_2_APPS_ADDR A:0x1e3203c
y.create.l HWIO_APPS_SMMU_CB19_NMRR_MAIR1_2_APPS_ADDR A:0x1e3303c
y.create.l HWIO_APPS_SMMU_CB20_NMRR_MAIR1_2_APPS_ADDR A:0x1e3403c
y.create.l HWIO_APPS_SMMU_CB21_NMRR_MAIR1_2_APPS_ADDR A:0x1e3503c
y.create.l HWIO_APPS_SMMU_CB22_NMRR_MAIR1_2_APPS_ADDR A:0x1e3603c
y.create.l HWIO_APPS_SMMU_CB23_NMRR_MAIR1_2_APPS_ADDR A:0x1e3703c
y.create.l HWIO_APPS_SMMU_CB24_NMRR_MAIR1_2_APPS_ADDR A:0x1e3803c
y.create.l HWIO_APPS_SMMU_CB25_NMRR_MAIR1_2_APPS_ADDR A:0x1e3903c
y.create.l HWIO_APPS_SMMU_CB26_NMRR_MAIR1_2_APPS_ADDR A:0x1e3a03c
y.create.l HWIO_APPS_SMMU_CB27_NMRR_MAIR1_2_APPS_ADDR A:0x1e3b03c
y.create.l HWIO_APPS_SMMU_CB28_NMRR_MAIR1_2_APPS_ADDR A:0x1e3c03c
y.create.l HWIO_APPS_SMMU_CB29_NMRR_MAIR1_2_APPS_ADDR A:0x1e3d03c
y.create.l HWIO_APPS_SMMU_CB30_NMRR_MAIR1_2_APPS_ADDR A:0x1e3e03c
y.create.l HWIO_APPS_SMMU_CB31_NMRR_MAIR1_2_APPS_ADDR A:0x1e3f03c
y.create.l HWIO_APPS_SMMU_CB0_FSR_2_APPS_ADDR A:0x1e20058
y.create.l HWIO_APPS_SMMU_CB1_FSR_2_APPS_ADDR A:0x1e21058
y.create.l HWIO_APPS_SMMU_CB2_FSR_2_APPS_ADDR A:0x1e22058
y.create.l HWIO_APPS_SMMU_CB3_FSR_2_APPS_ADDR A:0x1e23058
y.create.l HWIO_APPS_SMMU_CB4_FSR_2_APPS_ADDR A:0x1e24058
y.create.l HWIO_APPS_SMMU_CB5_FSR_2_APPS_ADDR A:0x1e25058
y.create.l HWIO_APPS_SMMU_CB6_FSR_2_APPS_ADDR A:0x1e26058
y.create.l HWIO_APPS_SMMU_CB7_FSR_2_APPS_ADDR A:0x1e27058
y.create.l HWIO_APPS_SMMU_CB8_FSR_2_APPS_ADDR A:0x1e28058
y.create.l HWIO_APPS_SMMU_CB9_FSR_2_APPS_ADDR A:0x1e29058
y.create.l HWIO_APPS_SMMU_CB10_FSR_2_APPS_ADDR A:0x1e2a058
y.create.l HWIO_APPS_SMMU_CB11_FSR_2_APPS_ADDR A:0x1e2b058
y.create.l HWIO_APPS_SMMU_CB12_FSR_2_APPS_ADDR A:0x1e2c058
y.create.l HWIO_APPS_SMMU_CB13_FSR_2_APPS_ADDR A:0x1e2d058
y.create.l HWIO_APPS_SMMU_CB14_FSR_2_APPS_ADDR A:0x1e2e058
y.create.l HWIO_APPS_SMMU_CB15_FSR_2_APPS_ADDR A:0x1e2f058
y.create.l HWIO_APPS_SMMU_CB16_FSR_2_APPS_ADDR A:0x1e30058
y.create.l HWIO_APPS_SMMU_CB17_FSR_2_APPS_ADDR A:0x1e31058
y.create.l HWIO_APPS_SMMU_CB18_FSR_2_APPS_ADDR A:0x1e32058
y.create.l HWIO_APPS_SMMU_CB19_FSR_2_APPS_ADDR A:0x1e33058
y.create.l HWIO_APPS_SMMU_CB20_FSR_2_APPS_ADDR A:0x1e34058
y.create.l HWIO_APPS_SMMU_CB21_FSR_2_APPS_ADDR A:0x1e35058
y.create.l HWIO_APPS_SMMU_CB22_FSR_2_APPS_ADDR A:0x1e36058
y.create.l HWIO_APPS_SMMU_CB23_FSR_2_APPS_ADDR A:0x1e37058
y.create.l HWIO_APPS_SMMU_CB24_FSR_2_APPS_ADDR A:0x1e38058
y.create.l HWIO_APPS_SMMU_CB25_FSR_2_APPS_ADDR A:0x1e39058
y.create.l HWIO_APPS_SMMU_CB26_FSR_2_APPS_ADDR A:0x1e3a058
y.create.l HWIO_APPS_SMMU_CB27_FSR_2_APPS_ADDR A:0x1e3b058
y.create.l HWIO_APPS_SMMU_CB28_FSR_2_APPS_ADDR A:0x1e3c058
y.create.l HWIO_APPS_SMMU_CB29_FSR_2_APPS_ADDR A:0x1e3d058
y.create.l HWIO_APPS_SMMU_CB30_FSR_2_APPS_ADDR A:0x1e3e058
y.create.l HWIO_APPS_SMMU_CB31_FSR_2_APPS_ADDR A:0x1e3f058
y.create.l HWIO_APPS_SMMU_CB0_FSRRESTORE_2_APPS_ADDR A:0x1e2005c
y.create.l HWIO_APPS_SMMU_CB1_FSRRESTORE_2_APPS_ADDR A:0x1e2105c
y.create.l HWIO_APPS_SMMU_CB2_FSRRESTORE_2_APPS_ADDR A:0x1e2205c
y.create.l HWIO_APPS_SMMU_CB3_FSRRESTORE_2_APPS_ADDR A:0x1e2305c
y.create.l HWIO_APPS_SMMU_CB4_FSRRESTORE_2_APPS_ADDR A:0x1e2405c
y.create.l HWIO_APPS_SMMU_CB5_FSRRESTORE_2_APPS_ADDR A:0x1e2505c
y.create.l HWIO_APPS_SMMU_CB6_FSRRESTORE_2_APPS_ADDR A:0x1e2605c
y.create.l HWIO_APPS_SMMU_CB7_FSRRESTORE_2_APPS_ADDR A:0x1e2705c
y.create.l HWIO_APPS_SMMU_CB8_FSRRESTORE_2_APPS_ADDR A:0x1e2805c
y.create.l HWIO_APPS_SMMU_CB9_FSRRESTORE_2_APPS_ADDR A:0x1e2905c
y.create.l HWIO_APPS_SMMU_CB10_FSRRESTORE_2_APPS_ADDR A:0x1e2a05c
y.create.l HWIO_APPS_SMMU_CB11_FSRRESTORE_2_APPS_ADDR A:0x1e2b05c
y.create.l HWIO_APPS_SMMU_CB12_FSRRESTORE_2_APPS_ADDR A:0x1e2c05c
y.create.l HWIO_APPS_SMMU_CB13_FSRRESTORE_2_APPS_ADDR A:0x1e2d05c
y.create.l HWIO_APPS_SMMU_CB14_FSRRESTORE_2_APPS_ADDR A:0x1e2e05c
y.create.l HWIO_APPS_SMMU_CB15_FSRRESTORE_2_APPS_ADDR A:0x1e2f05c
y.create.l HWIO_APPS_SMMU_CB16_FSRRESTORE_2_APPS_ADDR A:0x1e3005c
y.create.l HWIO_APPS_SMMU_CB17_FSRRESTORE_2_APPS_ADDR A:0x1e3105c
y.create.l HWIO_APPS_SMMU_CB18_FSRRESTORE_2_APPS_ADDR A:0x1e3205c
y.create.l HWIO_APPS_SMMU_CB19_FSRRESTORE_2_APPS_ADDR A:0x1e3305c
y.create.l HWIO_APPS_SMMU_CB20_FSRRESTORE_2_APPS_ADDR A:0x1e3405c
y.create.l HWIO_APPS_SMMU_CB21_FSRRESTORE_2_APPS_ADDR A:0x1e3505c
y.create.l HWIO_APPS_SMMU_CB22_FSRRESTORE_2_APPS_ADDR A:0x1e3605c
y.create.l HWIO_APPS_SMMU_CB23_FSRRESTORE_2_APPS_ADDR A:0x1e3705c
y.create.l HWIO_APPS_SMMU_CB24_FSRRESTORE_2_APPS_ADDR A:0x1e3805c
y.create.l HWIO_APPS_SMMU_CB25_FSRRESTORE_2_APPS_ADDR A:0x1e3905c
y.create.l HWIO_APPS_SMMU_CB26_FSRRESTORE_2_APPS_ADDR A:0x1e3a05c
y.create.l HWIO_APPS_SMMU_CB27_FSRRESTORE_2_APPS_ADDR A:0x1e3b05c
y.create.l HWIO_APPS_SMMU_CB28_FSRRESTORE_2_APPS_ADDR A:0x1e3c05c
y.create.l HWIO_APPS_SMMU_CB29_FSRRESTORE_2_APPS_ADDR A:0x1e3d05c
y.create.l HWIO_APPS_SMMU_CB30_FSRRESTORE_2_APPS_ADDR A:0x1e3e05c
y.create.l HWIO_APPS_SMMU_CB31_FSRRESTORE_2_APPS_ADDR A:0x1e3f05c
y.create.l HWIO_APPS_SMMU_CB0_FAR_LOW_2_APPS_ADDR A:0x1e20060
y.create.l HWIO_APPS_SMMU_CB1_FAR_LOW_2_APPS_ADDR A:0x1e21060
y.create.l HWIO_APPS_SMMU_CB2_FAR_LOW_2_APPS_ADDR A:0x1e22060
y.create.l HWIO_APPS_SMMU_CB3_FAR_LOW_2_APPS_ADDR A:0x1e23060
y.create.l HWIO_APPS_SMMU_CB4_FAR_LOW_2_APPS_ADDR A:0x1e24060
y.create.l HWIO_APPS_SMMU_CB5_FAR_LOW_2_APPS_ADDR A:0x1e25060
y.create.l HWIO_APPS_SMMU_CB6_FAR_LOW_2_APPS_ADDR A:0x1e26060
y.create.l HWIO_APPS_SMMU_CB7_FAR_LOW_2_APPS_ADDR A:0x1e27060
y.create.l HWIO_APPS_SMMU_CB8_FAR_LOW_2_APPS_ADDR A:0x1e28060
y.create.l HWIO_APPS_SMMU_CB9_FAR_LOW_2_APPS_ADDR A:0x1e29060
y.create.l HWIO_APPS_SMMU_CB10_FAR_LOW_2_APPS_ADDR A:0x1e2a060
y.create.l HWIO_APPS_SMMU_CB11_FAR_LOW_2_APPS_ADDR A:0x1e2b060
y.create.l HWIO_APPS_SMMU_CB12_FAR_LOW_2_APPS_ADDR A:0x1e2c060
y.create.l HWIO_APPS_SMMU_CB13_FAR_LOW_2_APPS_ADDR A:0x1e2d060
y.create.l HWIO_APPS_SMMU_CB14_FAR_LOW_2_APPS_ADDR A:0x1e2e060
y.create.l HWIO_APPS_SMMU_CB15_FAR_LOW_2_APPS_ADDR A:0x1e2f060
y.create.l HWIO_APPS_SMMU_CB16_FAR_LOW_2_APPS_ADDR A:0x1e30060
y.create.l HWIO_APPS_SMMU_CB17_FAR_LOW_2_APPS_ADDR A:0x1e31060
y.create.l HWIO_APPS_SMMU_CB18_FAR_LOW_2_APPS_ADDR A:0x1e32060
y.create.l HWIO_APPS_SMMU_CB19_FAR_LOW_2_APPS_ADDR A:0x1e33060
y.create.l HWIO_APPS_SMMU_CB20_FAR_LOW_2_APPS_ADDR A:0x1e34060
y.create.l HWIO_APPS_SMMU_CB21_FAR_LOW_2_APPS_ADDR A:0x1e35060
y.create.l HWIO_APPS_SMMU_CB22_FAR_LOW_2_APPS_ADDR A:0x1e36060
y.create.l HWIO_APPS_SMMU_CB23_FAR_LOW_2_APPS_ADDR A:0x1e37060
y.create.l HWIO_APPS_SMMU_CB24_FAR_LOW_2_APPS_ADDR A:0x1e38060
y.create.l HWIO_APPS_SMMU_CB25_FAR_LOW_2_APPS_ADDR A:0x1e39060
y.create.l HWIO_APPS_SMMU_CB26_FAR_LOW_2_APPS_ADDR A:0x1e3a060
y.create.l HWIO_APPS_SMMU_CB27_FAR_LOW_2_APPS_ADDR A:0x1e3b060
y.create.l HWIO_APPS_SMMU_CB28_FAR_LOW_2_APPS_ADDR A:0x1e3c060
y.create.l HWIO_APPS_SMMU_CB29_FAR_LOW_2_APPS_ADDR A:0x1e3d060
y.create.l HWIO_APPS_SMMU_CB30_FAR_LOW_2_APPS_ADDR A:0x1e3e060
y.create.l HWIO_APPS_SMMU_CB31_FAR_LOW_2_APPS_ADDR A:0x1e3f060
y.create.l HWIO_APPS_SMMU_CB0_FAR_HIGH_2_APPS_ADDR A:0x1e20064
y.create.l HWIO_APPS_SMMU_CB1_FAR_HIGH_2_APPS_ADDR A:0x1e21064
y.create.l HWIO_APPS_SMMU_CB2_FAR_HIGH_2_APPS_ADDR A:0x1e22064
y.create.l HWIO_APPS_SMMU_CB3_FAR_HIGH_2_APPS_ADDR A:0x1e23064
y.create.l HWIO_APPS_SMMU_CB4_FAR_HIGH_2_APPS_ADDR A:0x1e24064
y.create.l HWIO_APPS_SMMU_CB5_FAR_HIGH_2_APPS_ADDR A:0x1e25064
y.create.l HWIO_APPS_SMMU_CB6_FAR_HIGH_2_APPS_ADDR A:0x1e26064
y.create.l HWIO_APPS_SMMU_CB7_FAR_HIGH_2_APPS_ADDR A:0x1e27064
y.create.l HWIO_APPS_SMMU_CB8_FAR_HIGH_2_APPS_ADDR A:0x1e28064
y.create.l HWIO_APPS_SMMU_CB9_FAR_HIGH_2_APPS_ADDR A:0x1e29064
y.create.l HWIO_APPS_SMMU_CB10_FAR_HIGH_2_APPS_ADDR A:0x1e2a064
y.create.l HWIO_APPS_SMMU_CB11_FAR_HIGH_2_APPS_ADDR A:0x1e2b064
y.create.l HWIO_APPS_SMMU_CB12_FAR_HIGH_2_APPS_ADDR A:0x1e2c064
y.create.l HWIO_APPS_SMMU_CB13_FAR_HIGH_2_APPS_ADDR A:0x1e2d064
y.create.l HWIO_APPS_SMMU_CB14_FAR_HIGH_2_APPS_ADDR A:0x1e2e064
y.create.l HWIO_APPS_SMMU_CB15_FAR_HIGH_2_APPS_ADDR A:0x1e2f064
y.create.l HWIO_APPS_SMMU_CB16_FAR_HIGH_2_APPS_ADDR A:0x1e30064
y.create.l HWIO_APPS_SMMU_CB17_FAR_HIGH_2_APPS_ADDR A:0x1e31064
y.create.l HWIO_APPS_SMMU_CB18_FAR_HIGH_2_APPS_ADDR A:0x1e32064
y.create.l HWIO_APPS_SMMU_CB19_FAR_HIGH_2_APPS_ADDR A:0x1e33064
y.create.l HWIO_APPS_SMMU_CB20_FAR_HIGH_2_APPS_ADDR A:0x1e34064
y.create.l HWIO_APPS_SMMU_CB21_FAR_HIGH_2_APPS_ADDR A:0x1e35064
y.create.l HWIO_APPS_SMMU_CB22_FAR_HIGH_2_APPS_ADDR A:0x1e36064
y.create.l HWIO_APPS_SMMU_CB23_FAR_HIGH_2_APPS_ADDR A:0x1e37064
y.create.l HWIO_APPS_SMMU_CB24_FAR_HIGH_2_APPS_ADDR A:0x1e38064
y.create.l HWIO_APPS_SMMU_CB25_FAR_HIGH_2_APPS_ADDR A:0x1e39064
y.create.l HWIO_APPS_SMMU_CB26_FAR_HIGH_2_APPS_ADDR A:0x1e3a064
y.create.l HWIO_APPS_SMMU_CB27_FAR_HIGH_2_APPS_ADDR A:0x1e3b064
y.create.l HWIO_APPS_SMMU_CB28_FAR_HIGH_2_APPS_ADDR A:0x1e3c064
y.create.l HWIO_APPS_SMMU_CB29_FAR_HIGH_2_APPS_ADDR A:0x1e3d064
y.create.l HWIO_APPS_SMMU_CB30_FAR_HIGH_2_APPS_ADDR A:0x1e3e064
y.create.l HWIO_APPS_SMMU_CB31_FAR_HIGH_2_APPS_ADDR A:0x1e3f064
y.create.l HWIO_APPS_SMMU_CB0_FSYNR0_2_APPS_ADDR A:0x1e20068
y.create.l HWIO_APPS_SMMU_CB1_FSYNR0_2_APPS_ADDR A:0x1e21068
y.create.l HWIO_APPS_SMMU_CB2_FSYNR0_2_APPS_ADDR A:0x1e22068
y.create.l HWIO_APPS_SMMU_CB3_FSYNR0_2_APPS_ADDR A:0x1e23068
y.create.l HWIO_APPS_SMMU_CB4_FSYNR0_2_APPS_ADDR A:0x1e24068
y.create.l HWIO_APPS_SMMU_CB5_FSYNR0_2_APPS_ADDR A:0x1e25068
y.create.l HWIO_APPS_SMMU_CB6_FSYNR0_2_APPS_ADDR A:0x1e26068
y.create.l HWIO_APPS_SMMU_CB7_FSYNR0_2_APPS_ADDR A:0x1e27068
y.create.l HWIO_APPS_SMMU_CB8_FSYNR0_2_APPS_ADDR A:0x1e28068
y.create.l HWIO_APPS_SMMU_CB9_FSYNR0_2_APPS_ADDR A:0x1e29068
y.create.l HWIO_APPS_SMMU_CB10_FSYNR0_2_APPS_ADDR A:0x1e2a068
y.create.l HWIO_APPS_SMMU_CB11_FSYNR0_2_APPS_ADDR A:0x1e2b068
y.create.l HWIO_APPS_SMMU_CB12_FSYNR0_2_APPS_ADDR A:0x1e2c068
y.create.l HWIO_APPS_SMMU_CB13_FSYNR0_2_APPS_ADDR A:0x1e2d068
y.create.l HWIO_APPS_SMMU_CB14_FSYNR0_2_APPS_ADDR A:0x1e2e068
y.create.l HWIO_APPS_SMMU_CB15_FSYNR0_2_APPS_ADDR A:0x1e2f068
y.create.l HWIO_APPS_SMMU_CB16_FSYNR0_2_APPS_ADDR A:0x1e30068
y.create.l HWIO_APPS_SMMU_CB17_FSYNR0_2_APPS_ADDR A:0x1e31068
y.create.l HWIO_APPS_SMMU_CB18_FSYNR0_2_APPS_ADDR A:0x1e32068
y.create.l HWIO_APPS_SMMU_CB19_FSYNR0_2_APPS_ADDR A:0x1e33068
y.create.l HWIO_APPS_SMMU_CB20_FSYNR0_2_APPS_ADDR A:0x1e34068
y.create.l HWIO_APPS_SMMU_CB21_FSYNR0_2_APPS_ADDR A:0x1e35068
y.create.l HWIO_APPS_SMMU_CB22_FSYNR0_2_APPS_ADDR A:0x1e36068
y.create.l HWIO_APPS_SMMU_CB23_FSYNR0_2_APPS_ADDR A:0x1e37068
y.create.l HWIO_APPS_SMMU_CB24_FSYNR0_2_APPS_ADDR A:0x1e38068
y.create.l HWIO_APPS_SMMU_CB25_FSYNR0_2_APPS_ADDR A:0x1e39068
y.create.l HWIO_APPS_SMMU_CB26_FSYNR0_2_APPS_ADDR A:0x1e3a068
y.create.l HWIO_APPS_SMMU_CB27_FSYNR0_2_APPS_ADDR A:0x1e3b068
y.create.l HWIO_APPS_SMMU_CB28_FSYNR0_2_APPS_ADDR A:0x1e3c068
y.create.l HWIO_APPS_SMMU_CB29_FSYNR0_2_APPS_ADDR A:0x1e3d068
y.create.l HWIO_APPS_SMMU_CB30_FSYNR0_2_APPS_ADDR A:0x1e3e068
y.create.l HWIO_APPS_SMMU_CB31_FSYNR0_2_APPS_ADDR A:0x1e3f068
y.create.l HWIO_APPS_SMMU_CB0_IPAFAR_LOW_2_APPS_ADDR A:0x1e20070
y.create.l HWIO_APPS_SMMU_CB1_IPAFAR_LOW_2_APPS_ADDR A:0x1e21070
y.create.l HWIO_APPS_SMMU_CB2_IPAFAR_LOW_2_APPS_ADDR A:0x1e22070
y.create.l HWIO_APPS_SMMU_CB3_IPAFAR_LOW_2_APPS_ADDR A:0x1e23070
y.create.l HWIO_APPS_SMMU_CB4_IPAFAR_LOW_2_APPS_ADDR A:0x1e24070
y.create.l HWIO_APPS_SMMU_CB5_IPAFAR_LOW_2_APPS_ADDR A:0x1e25070
y.create.l HWIO_APPS_SMMU_CB6_IPAFAR_LOW_2_APPS_ADDR A:0x1e26070
y.create.l HWIO_APPS_SMMU_CB7_IPAFAR_LOW_2_APPS_ADDR A:0x1e27070
y.create.l HWIO_APPS_SMMU_CB8_IPAFAR_LOW_2_APPS_ADDR A:0x1e28070
y.create.l HWIO_APPS_SMMU_CB9_IPAFAR_LOW_2_APPS_ADDR A:0x1e29070
y.create.l HWIO_APPS_SMMU_CB10_IPAFAR_LOW_2_APPS_ADDR A:0x1e2a070
y.create.l HWIO_APPS_SMMU_CB11_IPAFAR_LOW_2_APPS_ADDR A:0x1e2b070
y.create.l HWIO_APPS_SMMU_CB12_IPAFAR_LOW_2_APPS_ADDR A:0x1e2c070
y.create.l HWIO_APPS_SMMU_CB13_IPAFAR_LOW_2_APPS_ADDR A:0x1e2d070
y.create.l HWIO_APPS_SMMU_CB14_IPAFAR_LOW_2_APPS_ADDR A:0x1e2e070
y.create.l HWIO_APPS_SMMU_CB15_IPAFAR_LOW_2_APPS_ADDR A:0x1e2f070
y.create.l HWIO_APPS_SMMU_CB16_IPAFAR_LOW_2_APPS_ADDR A:0x1e30070
y.create.l HWIO_APPS_SMMU_CB17_IPAFAR_LOW_2_APPS_ADDR A:0x1e31070
y.create.l HWIO_APPS_SMMU_CB18_IPAFAR_LOW_2_APPS_ADDR A:0x1e32070
y.create.l HWIO_APPS_SMMU_CB19_IPAFAR_LOW_2_APPS_ADDR A:0x1e33070
y.create.l HWIO_APPS_SMMU_CB20_IPAFAR_LOW_2_APPS_ADDR A:0x1e34070
y.create.l HWIO_APPS_SMMU_CB21_IPAFAR_LOW_2_APPS_ADDR A:0x1e35070
y.create.l HWIO_APPS_SMMU_CB22_IPAFAR_LOW_2_APPS_ADDR A:0x1e36070
y.create.l HWIO_APPS_SMMU_CB23_IPAFAR_LOW_2_APPS_ADDR A:0x1e37070
y.create.l HWIO_APPS_SMMU_CB24_IPAFAR_LOW_2_APPS_ADDR A:0x1e38070
y.create.l HWIO_APPS_SMMU_CB25_IPAFAR_LOW_2_APPS_ADDR A:0x1e39070
y.create.l HWIO_APPS_SMMU_CB26_IPAFAR_LOW_2_APPS_ADDR A:0x1e3a070
y.create.l HWIO_APPS_SMMU_CB27_IPAFAR_LOW_2_APPS_ADDR A:0x1e3b070
y.create.l HWIO_APPS_SMMU_CB28_IPAFAR_LOW_2_APPS_ADDR A:0x1e3c070
y.create.l HWIO_APPS_SMMU_CB29_IPAFAR_LOW_2_APPS_ADDR A:0x1e3d070
y.create.l HWIO_APPS_SMMU_CB30_IPAFAR_LOW_2_APPS_ADDR A:0x1e3e070
y.create.l HWIO_APPS_SMMU_CB31_IPAFAR_LOW_2_APPS_ADDR A:0x1e3f070
y.create.l HWIO_APPS_SMMU_CB0_IPAFAR_HIGH_2_APPS_ADDR A:0x1e20074
y.create.l HWIO_APPS_SMMU_CB1_IPAFAR_HIGH_2_APPS_ADDR A:0x1e21074
y.create.l HWIO_APPS_SMMU_CB2_IPAFAR_HIGH_2_APPS_ADDR A:0x1e22074
y.create.l HWIO_APPS_SMMU_CB3_IPAFAR_HIGH_2_APPS_ADDR A:0x1e23074
y.create.l HWIO_APPS_SMMU_CB4_IPAFAR_HIGH_2_APPS_ADDR A:0x1e24074
y.create.l HWIO_APPS_SMMU_CB5_IPAFAR_HIGH_2_APPS_ADDR A:0x1e25074
y.create.l HWIO_APPS_SMMU_CB6_IPAFAR_HIGH_2_APPS_ADDR A:0x1e26074
y.create.l HWIO_APPS_SMMU_CB7_IPAFAR_HIGH_2_APPS_ADDR A:0x1e27074
y.create.l HWIO_APPS_SMMU_CB8_IPAFAR_HIGH_2_APPS_ADDR A:0x1e28074
y.create.l HWIO_APPS_SMMU_CB9_IPAFAR_HIGH_2_APPS_ADDR A:0x1e29074
y.create.l HWIO_APPS_SMMU_CB10_IPAFAR_HIGH_2_APPS_ADDR A:0x1e2a074
y.create.l HWIO_APPS_SMMU_CB11_IPAFAR_HIGH_2_APPS_ADDR A:0x1e2b074
y.create.l HWIO_APPS_SMMU_CB12_IPAFAR_HIGH_2_APPS_ADDR A:0x1e2c074
y.create.l HWIO_APPS_SMMU_CB13_IPAFAR_HIGH_2_APPS_ADDR A:0x1e2d074
y.create.l HWIO_APPS_SMMU_CB14_IPAFAR_HIGH_2_APPS_ADDR A:0x1e2e074
y.create.l HWIO_APPS_SMMU_CB15_IPAFAR_HIGH_2_APPS_ADDR A:0x1e2f074
y.create.l HWIO_APPS_SMMU_CB16_IPAFAR_HIGH_2_APPS_ADDR A:0x1e30074
y.create.l HWIO_APPS_SMMU_CB17_IPAFAR_HIGH_2_APPS_ADDR A:0x1e31074
y.create.l HWIO_APPS_SMMU_CB18_IPAFAR_HIGH_2_APPS_ADDR A:0x1e32074
y.create.l HWIO_APPS_SMMU_CB19_IPAFAR_HIGH_2_APPS_ADDR A:0x1e33074
y.create.l HWIO_APPS_SMMU_CB20_IPAFAR_HIGH_2_APPS_ADDR A:0x1e34074
y.create.l HWIO_APPS_SMMU_CB21_IPAFAR_HIGH_2_APPS_ADDR A:0x1e35074
y.create.l HWIO_APPS_SMMU_CB22_IPAFAR_HIGH_2_APPS_ADDR A:0x1e36074
y.create.l HWIO_APPS_SMMU_CB23_IPAFAR_HIGH_2_APPS_ADDR A:0x1e37074
y.create.l HWIO_APPS_SMMU_CB24_IPAFAR_HIGH_2_APPS_ADDR A:0x1e38074
y.create.l HWIO_APPS_SMMU_CB25_IPAFAR_HIGH_2_APPS_ADDR A:0x1e39074
y.create.l HWIO_APPS_SMMU_CB26_IPAFAR_HIGH_2_APPS_ADDR A:0x1e3a074
y.create.l HWIO_APPS_SMMU_CB27_IPAFAR_HIGH_2_APPS_ADDR A:0x1e3b074
y.create.l HWIO_APPS_SMMU_CB28_IPAFAR_HIGH_2_APPS_ADDR A:0x1e3c074
y.create.l HWIO_APPS_SMMU_CB29_IPAFAR_HIGH_2_APPS_ADDR A:0x1e3d074
y.create.l HWIO_APPS_SMMU_CB30_IPAFAR_HIGH_2_APPS_ADDR A:0x1e3e074
y.create.l HWIO_APPS_SMMU_CB31_IPAFAR_HIGH_2_APPS_ADDR A:0x1e3f074
y.create.l HWIO_APPS_SMMU_CB0_TLBIVA_LOW_2_APPS_ADDR A:0x1e20600
y.create.l HWIO_APPS_SMMU_CB1_TLBIVA_LOW_2_APPS_ADDR A:0x1e21600
y.create.l HWIO_APPS_SMMU_CB2_TLBIVA_LOW_2_APPS_ADDR A:0x1e22600
y.create.l HWIO_APPS_SMMU_CB3_TLBIVA_LOW_2_APPS_ADDR A:0x1e23600
y.create.l HWIO_APPS_SMMU_CB4_TLBIVA_LOW_2_APPS_ADDR A:0x1e24600
y.create.l HWIO_APPS_SMMU_CB5_TLBIVA_LOW_2_APPS_ADDR A:0x1e25600
y.create.l HWIO_APPS_SMMU_CB6_TLBIVA_LOW_2_APPS_ADDR A:0x1e26600
y.create.l HWIO_APPS_SMMU_CB7_TLBIVA_LOW_2_APPS_ADDR A:0x1e27600
y.create.l HWIO_APPS_SMMU_CB8_TLBIVA_LOW_2_APPS_ADDR A:0x1e28600
y.create.l HWIO_APPS_SMMU_CB9_TLBIVA_LOW_2_APPS_ADDR A:0x1e29600
y.create.l HWIO_APPS_SMMU_CB10_TLBIVA_LOW_2_APPS_ADDR A:0x1e2a600
y.create.l HWIO_APPS_SMMU_CB11_TLBIVA_LOW_2_APPS_ADDR A:0x1e2b600
y.create.l HWIO_APPS_SMMU_CB12_TLBIVA_LOW_2_APPS_ADDR A:0x1e2c600
y.create.l HWIO_APPS_SMMU_CB13_TLBIVA_LOW_2_APPS_ADDR A:0x1e2d600
y.create.l HWIO_APPS_SMMU_CB14_TLBIVA_LOW_2_APPS_ADDR A:0x1e2e600
y.create.l HWIO_APPS_SMMU_CB15_TLBIVA_LOW_2_APPS_ADDR A:0x1e2f600
y.create.l HWIO_APPS_SMMU_CB16_TLBIVA_LOW_2_APPS_ADDR A:0x1e30600
y.create.l HWIO_APPS_SMMU_CB17_TLBIVA_LOW_2_APPS_ADDR A:0x1e31600
y.create.l HWIO_APPS_SMMU_CB18_TLBIVA_LOW_2_APPS_ADDR A:0x1e32600
y.create.l HWIO_APPS_SMMU_CB19_TLBIVA_LOW_2_APPS_ADDR A:0x1e33600
y.create.l HWIO_APPS_SMMU_CB20_TLBIVA_LOW_2_APPS_ADDR A:0x1e34600
y.create.l HWIO_APPS_SMMU_CB21_TLBIVA_LOW_2_APPS_ADDR A:0x1e35600
y.create.l HWIO_APPS_SMMU_CB22_TLBIVA_LOW_2_APPS_ADDR A:0x1e36600
y.create.l HWIO_APPS_SMMU_CB23_TLBIVA_LOW_2_APPS_ADDR A:0x1e37600
y.create.l HWIO_APPS_SMMU_CB24_TLBIVA_LOW_2_APPS_ADDR A:0x1e38600
y.create.l HWIO_APPS_SMMU_CB25_TLBIVA_LOW_2_APPS_ADDR A:0x1e39600
y.create.l HWIO_APPS_SMMU_CB26_TLBIVA_LOW_2_APPS_ADDR A:0x1e3a600
y.create.l HWIO_APPS_SMMU_CB27_TLBIVA_LOW_2_APPS_ADDR A:0x1e3b600
y.create.l HWIO_APPS_SMMU_CB28_TLBIVA_LOW_2_APPS_ADDR A:0x1e3c600
y.create.l HWIO_APPS_SMMU_CB29_TLBIVA_LOW_2_APPS_ADDR A:0x1e3d600
y.create.l HWIO_APPS_SMMU_CB30_TLBIVA_LOW_2_APPS_ADDR A:0x1e3e600
y.create.l HWIO_APPS_SMMU_CB31_TLBIVA_LOW_2_APPS_ADDR A:0x1e3f600
y.create.l HWIO_APPS_SMMU_CB0_TLBIVA_HIGH_2_APPS_ADDR A:0x1e20604
y.create.l HWIO_APPS_SMMU_CB1_TLBIVA_HIGH_2_APPS_ADDR A:0x1e21604
y.create.l HWIO_APPS_SMMU_CB2_TLBIVA_HIGH_2_APPS_ADDR A:0x1e22604
y.create.l HWIO_APPS_SMMU_CB3_TLBIVA_HIGH_2_APPS_ADDR A:0x1e23604
y.create.l HWIO_APPS_SMMU_CB4_TLBIVA_HIGH_2_APPS_ADDR A:0x1e24604
y.create.l HWIO_APPS_SMMU_CB5_TLBIVA_HIGH_2_APPS_ADDR A:0x1e25604
y.create.l HWIO_APPS_SMMU_CB6_TLBIVA_HIGH_2_APPS_ADDR A:0x1e26604
y.create.l HWIO_APPS_SMMU_CB7_TLBIVA_HIGH_2_APPS_ADDR A:0x1e27604
y.create.l HWIO_APPS_SMMU_CB8_TLBIVA_HIGH_2_APPS_ADDR A:0x1e28604
y.create.l HWIO_APPS_SMMU_CB9_TLBIVA_HIGH_2_APPS_ADDR A:0x1e29604
y.create.l HWIO_APPS_SMMU_CB10_TLBIVA_HIGH_2_APPS_ADDR A:0x1e2a604
y.create.l HWIO_APPS_SMMU_CB11_TLBIVA_HIGH_2_APPS_ADDR A:0x1e2b604
y.create.l HWIO_APPS_SMMU_CB12_TLBIVA_HIGH_2_APPS_ADDR A:0x1e2c604
y.create.l HWIO_APPS_SMMU_CB13_TLBIVA_HIGH_2_APPS_ADDR A:0x1e2d604
y.create.l HWIO_APPS_SMMU_CB14_TLBIVA_HIGH_2_APPS_ADDR A:0x1e2e604
y.create.l HWIO_APPS_SMMU_CB15_TLBIVA_HIGH_2_APPS_ADDR A:0x1e2f604
y.create.l HWIO_APPS_SMMU_CB16_TLBIVA_HIGH_2_APPS_ADDR A:0x1e30604
y.create.l HWIO_APPS_SMMU_CB17_TLBIVA_HIGH_2_APPS_ADDR A:0x1e31604
y.create.l HWIO_APPS_SMMU_CB18_TLBIVA_HIGH_2_APPS_ADDR A:0x1e32604
y.create.l HWIO_APPS_SMMU_CB19_TLBIVA_HIGH_2_APPS_ADDR A:0x1e33604
y.create.l HWIO_APPS_SMMU_CB20_TLBIVA_HIGH_2_APPS_ADDR A:0x1e34604
y.create.l HWIO_APPS_SMMU_CB21_TLBIVA_HIGH_2_APPS_ADDR A:0x1e35604
y.create.l HWIO_APPS_SMMU_CB22_TLBIVA_HIGH_2_APPS_ADDR A:0x1e36604
y.create.l HWIO_APPS_SMMU_CB23_TLBIVA_HIGH_2_APPS_ADDR A:0x1e37604
y.create.l HWIO_APPS_SMMU_CB24_TLBIVA_HIGH_2_APPS_ADDR A:0x1e38604
y.create.l HWIO_APPS_SMMU_CB25_TLBIVA_HIGH_2_APPS_ADDR A:0x1e39604
y.create.l HWIO_APPS_SMMU_CB26_TLBIVA_HIGH_2_APPS_ADDR A:0x1e3a604
y.create.l HWIO_APPS_SMMU_CB27_TLBIVA_HIGH_2_APPS_ADDR A:0x1e3b604
y.create.l HWIO_APPS_SMMU_CB28_TLBIVA_HIGH_2_APPS_ADDR A:0x1e3c604
y.create.l HWIO_APPS_SMMU_CB29_TLBIVA_HIGH_2_APPS_ADDR A:0x1e3d604
y.create.l HWIO_APPS_SMMU_CB30_TLBIVA_HIGH_2_APPS_ADDR A:0x1e3e604
y.create.l HWIO_APPS_SMMU_CB31_TLBIVA_HIGH_2_APPS_ADDR A:0x1e3f604
y.create.l HWIO_APPS_SMMU_CB0_TLBIVAA_LOW_2_APPS_ADDR A:0x1e20608
y.create.l HWIO_APPS_SMMU_CB1_TLBIVAA_LOW_2_APPS_ADDR A:0x1e21608
y.create.l HWIO_APPS_SMMU_CB2_TLBIVAA_LOW_2_APPS_ADDR A:0x1e22608
y.create.l HWIO_APPS_SMMU_CB3_TLBIVAA_LOW_2_APPS_ADDR A:0x1e23608
y.create.l HWIO_APPS_SMMU_CB4_TLBIVAA_LOW_2_APPS_ADDR A:0x1e24608
y.create.l HWIO_APPS_SMMU_CB5_TLBIVAA_LOW_2_APPS_ADDR A:0x1e25608
y.create.l HWIO_APPS_SMMU_CB6_TLBIVAA_LOW_2_APPS_ADDR A:0x1e26608
y.create.l HWIO_APPS_SMMU_CB7_TLBIVAA_LOW_2_APPS_ADDR A:0x1e27608
y.create.l HWIO_APPS_SMMU_CB8_TLBIVAA_LOW_2_APPS_ADDR A:0x1e28608
y.create.l HWIO_APPS_SMMU_CB9_TLBIVAA_LOW_2_APPS_ADDR A:0x1e29608
y.create.l HWIO_APPS_SMMU_CB10_TLBIVAA_LOW_2_APPS_ADDR A:0x1e2a608
y.create.l HWIO_APPS_SMMU_CB11_TLBIVAA_LOW_2_APPS_ADDR A:0x1e2b608
y.create.l HWIO_APPS_SMMU_CB12_TLBIVAA_LOW_2_APPS_ADDR A:0x1e2c608
y.create.l HWIO_APPS_SMMU_CB13_TLBIVAA_LOW_2_APPS_ADDR A:0x1e2d608
y.create.l HWIO_APPS_SMMU_CB14_TLBIVAA_LOW_2_APPS_ADDR A:0x1e2e608
y.create.l HWIO_APPS_SMMU_CB15_TLBIVAA_LOW_2_APPS_ADDR A:0x1e2f608
y.create.l HWIO_APPS_SMMU_CB16_TLBIVAA_LOW_2_APPS_ADDR A:0x1e30608
y.create.l HWIO_APPS_SMMU_CB17_TLBIVAA_LOW_2_APPS_ADDR A:0x1e31608
y.create.l HWIO_APPS_SMMU_CB18_TLBIVAA_LOW_2_APPS_ADDR A:0x1e32608
y.create.l HWIO_APPS_SMMU_CB19_TLBIVAA_LOW_2_APPS_ADDR A:0x1e33608
y.create.l HWIO_APPS_SMMU_CB20_TLBIVAA_LOW_2_APPS_ADDR A:0x1e34608
y.create.l HWIO_APPS_SMMU_CB21_TLBIVAA_LOW_2_APPS_ADDR A:0x1e35608
y.create.l HWIO_APPS_SMMU_CB22_TLBIVAA_LOW_2_APPS_ADDR A:0x1e36608
y.create.l HWIO_APPS_SMMU_CB23_TLBIVAA_LOW_2_APPS_ADDR A:0x1e37608
y.create.l HWIO_APPS_SMMU_CB24_TLBIVAA_LOW_2_APPS_ADDR A:0x1e38608
y.create.l HWIO_APPS_SMMU_CB25_TLBIVAA_LOW_2_APPS_ADDR A:0x1e39608
y.create.l HWIO_APPS_SMMU_CB26_TLBIVAA_LOW_2_APPS_ADDR A:0x1e3a608
y.create.l HWIO_APPS_SMMU_CB27_TLBIVAA_LOW_2_APPS_ADDR A:0x1e3b608
y.create.l HWIO_APPS_SMMU_CB28_TLBIVAA_LOW_2_APPS_ADDR A:0x1e3c608
y.create.l HWIO_APPS_SMMU_CB29_TLBIVAA_LOW_2_APPS_ADDR A:0x1e3d608
y.create.l HWIO_APPS_SMMU_CB30_TLBIVAA_LOW_2_APPS_ADDR A:0x1e3e608
y.create.l HWIO_APPS_SMMU_CB31_TLBIVAA_LOW_2_APPS_ADDR A:0x1e3f608
y.create.l HWIO_APPS_SMMU_CB0_TLBIVAA_HIGH_2_APPS_ADDR A:0x1e2060c
y.create.l HWIO_APPS_SMMU_CB1_TLBIVAA_HIGH_2_APPS_ADDR A:0x1e2160c
y.create.l HWIO_APPS_SMMU_CB2_TLBIVAA_HIGH_2_APPS_ADDR A:0x1e2260c
y.create.l HWIO_APPS_SMMU_CB3_TLBIVAA_HIGH_2_APPS_ADDR A:0x1e2360c
y.create.l HWIO_APPS_SMMU_CB4_TLBIVAA_HIGH_2_APPS_ADDR A:0x1e2460c
y.create.l HWIO_APPS_SMMU_CB5_TLBIVAA_HIGH_2_APPS_ADDR A:0x1e2560c
y.create.l HWIO_APPS_SMMU_CB6_TLBIVAA_HIGH_2_APPS_ADDR A:0x1e2660c
y.create.l HWIO_APPS_SMMU_CB7_TLBIVAA_HIGH_2_APPS_ADDR A:0x1e2760c
y.create.l HWIO_APPS_SMMU_CB8_TLBIVAA_HIGH_2_APPS_ADDR A:0x1e2860c
y.create.l HWIO_APPS_SMMU_CB9_TLBIVAA_HIGH_2_APPS_ADDR A:0x1e2960c
y.create.l HWIO_APPS_SMMU_CB10_TLBIVAA_HIGH_2_APPS_ADDR A:0x1e2a60c
y.create.l HWIO_APPS_SMMU_CB11_TLBIVAA_HIGH_2_APPS_ADDR A:0x1e2b60c
y.create.l HWIO_APPS_SMMU_CB12_TLBIVAA_HIGH_2_APPS_ADDR A:0x1e2c60c
y.create.l HWIO_APPS_SMMU_CB13_TLBIVAA_HIGH_2_APPS_ADDR A:0x1e2d60c
y.create.l HWIO_APPS_SMMU_CB14_TLBIVAA_HIGH_2_APPS_ADDR A:0x1e2e60c
y.create.l HWIO_APPS_SMMU_CB15_TLBIVAA_HIGH_2_APPS_ADDR A:0x1e2f60c
y.create.l HWIO_APPS_SMMU_CB16_TLBIVAA_HIGH_2_APPS_ADDR A:0x1e3060c
y.create.l HWIO_APPS_SMMU_CB17_TLBIVAA_HIGH_2_APPS_ADDR A:0x1e3160c
y.create.l HWIO_APPS_SMMU_CB18_TLBIVAA_HIGH_2_APPS_ADDR A:0x1e3260c
y.create.l HWIO_APPS_SMMU_CB19_TLBIVAA_HIGH_2_APPS_ADDR A:0x1e3360c
y.create.l HWIO_APPS_SMMU_CB20_TLBIVAA_HIGH_2_APPS_ADDR A:0x1e3460c
y.create.l HWIO_APPS_SMMU_CB21_TLBIVAA_HIGH_2_APPS_ADDR A:0x1e3560c
y.create.l HWIO_APPS_SMMU_CB22_TLBIVAA_HIGH_2_APPS_ADDR A:0x1e3660c
y.create.l HWIO_APPS_SMMU_CB23_TLBIVAA_HIGH_2_APPS_ADDR A:0x1e3760c
y.create.l HWIO_APPS_SMMU_CB24_TLBIVAA_HIGH_2_APPS_ADDR A:0x1e3860c
y.create.l HWIO_APPS_SMMU_CB25_TLBIVAA_HIGH_2_APPS_ADDR A:0x1e3960c
y.create.l HWIO_APPS_SMMU_CB26_TLBIVAA_HIGH_2_APPS_ADDR A:0x1e3a60c
y.create.l HWIO_APPS_SMMU_CB27_TLBIVAA_HIGH_2_APPS_ADDR A:0x1e3b60c
y.create.l HWIO_APPS_SMMU_CB28_TLBIVAA_HIGH_2_APPS_ADDR A:0x1e3c60c
y.create.l HWIO_APPS_SMMU_CB29_TLBIVAA_HIGH_2_APPS_ADDR A:0x1e3d60c
y.create.l HWIO_APPS_SMMU_CB30_TLBIVAA_HIGH_2_APPS_ADDR A:0x1e3e60c
y.create.l HWIO_APPS_SMMU_CB31_TLBIVAA_HIGH_2_APPS_ADDR A:0x1e3f60c
y.create.l HWIO_APPS_SMMU_CB0_TLBIASID_2_APPS_ADDR A:0x1e20610
y.create.l HWIO_APPS_SMMU_CB1_TLBIASID_2_APPS_ADDR A:0x1e21610
y.create.l HWIO_APPS_SMMU_CB2_TLBIASID_2_APPS_ADDR A:0x1e22610
y.create.l HWIO_APPS_SMMU_CB3_TLBIASID_2_APPS_ADDR A:0x1e23610
y.create.l HWIO_APPS_SMMU_CB4_TLBIASID_2_APPS_ADDR A:0x1e24610
y.create.l HWIO_APPS_SMMU_CB5_TLBIASID_2_APPS_ADDR A:0x1e25610
y.create.l HWIO_APPS_SMMU_CB6_TLBIASID_2_APPS_ADDR A:0x1e26610
y.create.l HWIO_APPS_SMMU_CB7_TLBIASID_2_APPS_ADDR A:0x1e27610
y.create.l HWIO_APPS_SMMU_CB8_TLBIASID_2_APPS_ADDR A:0x1e28610
y.create.l HWIO_APPS_SMMU_CB9_TLBIASID_2_APPS_ADDR A:0x1e29610
y.create.l HWIO_APPS_SMMU_CB10_TLBIASID_2_APPS_ADDR A:0x1e2a610
y.create.l HWIO_APPS_SMMU_CB11_TLBIASID_2_APPS_ADDR A:0x1e2b610
y.create.l HWIO_APPS_SMMU_CB12_TLBIASID_2_APPS_ADDR A:0x1e2c610
y.create.l HWIO_APPS_SMMU_CB13_TLBIASID_2_APPS_ADDR A:0x1e2d610
y.create.l HWIO_APPS_SMMU_CB14_TLBIASID_2_APPS_ADDR A:0x1e2e610
y.create.l HWIO_APPS_SMMU_CB15_TLBIASID_2_APPS_ADDR A:0x1e2f610
y.create.l HWIO_APPS_SMMU_CB16_TLBIASID_2_APPS_ADDR A:0x1e30610
y.create.l HWIO_APPS_SMMU_CB17_TLBIASID_2_APPS_ADDR A:0x1e31610
y.create.l HWIO_APPS_SMMU_CB18_TLBIASID_2_APPS_ADDR A:0x1e32610
y.create.l HWIO_APPS_SMMU_CB19_TLBIASID_2_APPS_ADDR A:0x1e33610
y.create.l HWIO_APPS_SMMU_CB20_TLBIASID_2_APPS_ADDR A:0x1e34610
y.create.l HWIO_APPS_SMMU_CB21_TLBIASID_2_APPS_ADDR A:0x1e35610
y.create.l HWIO_APPS_SMMU_CB22_TLBIASID_2_APPS_ADDR A:0x1e36610
y.create.l HWIO_APPS_SMMU_CB23_TLBIASID_2_APPS_ADDR A:0x1e37610
y.create.l HWIO_APPS_SMMU_CB24_TLBIASID_2_APPS_ADDR A:0x1e38610
y.create.l HWIO_APPS_SMMU_CB25_TLBIASID_2_APPS_ADDR A:0x1e39610
y.create.l HWIO_APPS_SMMU_CB26_TLBIASID_2_APPS_ADDR A:0x1e3a610
y.create.l HWIO_APPS_SMMU_CB27_TLBIASID_2_APPS_ADDR A:0x1e3b610
y.create.l HWIO_APPS_SMMU_CB28_TLBIASID_2_APPS_ADDR A:0x1e3c610
y.create.l HWIO_APPS_SMMU_CB29_TLBIASID_2_APPS_ADDR A:0x1e3d610
y.create.l HWIO_APPS_SMMU_CB30_TLBIASID_2_APPS_ADDR A:0x1e3e610
y.create.l HWIO_APPS_SMMU_CB31_TLBIASID_2_APPS_ADDR A:0x1e3f610
y.create.l HWIO_APPS_SMMU_CB0_TLBIALL_2_APPS_ADDR A:0x1e20618
y.create.l HWIO_APPS_SMMU_CB1_TLBIALL_2_APPS_ADDR A:0x1e21618
y.create.l HWIO_APPS_SMMU_CB2_TLBIALL_2_APPS_ADDR A:0x1e22618
y.create.l HWIO_APPS_SMMU_CB3_TLBIALL_2_APPS_ADDR A:0x1e23618
y.create.l HWIO_APPS_SMMU_CB4_TLBIALL_2_APPS_ADDR A:0x1e24618
y.create.l HWIO_APPS_SMMU_CB5_TLBIALL_2_APPS_ADDR A:0x1e25618
y.create.l HWIO_APPS_SMMU_CB6_TLBIALL_2_APPS_ADDR A:0x1e26618
y.create.l HWIO_APPS_SMMU_CB7_TLBIALL_2_APPS_ADDR A:0x1e27618
y.create.l HWIO_APPS_SMMU_CB8_TLBIALL_2_APPS_ADDR A:0x1e28618
y.create.l HWIO_APPS_SMMU_CB9_TLBIALL_2_APPS_ADDR A:0x1e29618
y.create.l HWIO_APPS_SMMU_CB10_TLBIALL_2_APPS_ADDR A:0x1e2a618
y.create.l HWIO_APPS_SMMU_CB11_TLBIALL_2_APPS_ADDR A:0x1e2b618
y.create.l HWIO_APPS_SMMU_CB12_TLBIALL_2_APPS_ADDR A:0x1e2c618
y.create.l HWIO_APPS_SMMU_CB13_TLBIALL_2_APPS_ADDR A:0x1e2d618
y.create.l HWIO_APPS_SMMU_CB14_TLBIALL_2_APPS_ADDR A:0x1e2e618
y.create.l HWIO_APPS_SMMU_CB15_TLBIALL_2_APPS_ADDR A:0x1e2f618
y.create.l HWIO_APPS_SMMU_CB16_TLBIALL_2_APPS_ADDR A:0x1e30618
y.create.l HWIO_APPS_SMMU_CB17_TLBIALL_2_APPS_ADDR A:0x1e31618
y.create.l HWIO_APPS_SMMU_CB18_TLBIALL_2_APPS_ADDR A:0x1e32618
y.create.l HWIO_APPS_SMMU_CB19_TLBIALL_2_APPS_ADDR A:0x1e33618
y.create.l HWIO_APPS_SMMU_CB20_TLBIALL_2_APPS_ADDR A:0x1e34618
y.create.l HWIO_APPS_SMMU_CB21_TLBIALL_2_APPS_ADDR A:0x1e35618
y.create.l HWIO_APPS_SMMU_CB22_TLBIALL_2_APPS_ADDR A:0x1e36618
y.create.l HWIO_APPS_SMMU_CB23_TLBIALL_2_APPS_ADDR A:0x1e37618
y.create.l HWIO_APPS_SMMU_CB24_TLBIALL_2_APPS_ADDR A:0x1e38618
y.create.l HWIO_APPS_SMMU_CB25_TLBIALL_2_APPS_ADDR A:0x1e39618
y.create.l HWIO_APPS_SMMU_CB26_TLBIALL_2_APPS_ADDR A:0x1e3a618
y.create.l HWIO_APPS_SMMU_CB27_TLBIALL_2_APPS_ADDR A:0x1e3b618
y.create.l HWIO_APPS_SMMU_CB28_TLBIALL_2_APPS_ADDR A:0x1e3c618
y.create.l HWIO_APPS_SMMU_CB29_TLBIALL_2_APPS_ADDR A:0x1e3d618
y.create.l HWIO_APPS_SMMU_CB30_TLBIALL_2_APPS_ADDR A:0x1e3e618
y.create.l HWIO_APPS_SMMU_CB31_TLBIALL_2_APPS_ADDR A:0x1e3f618
y.create.l HWIO_APPS_SMMU_CB0_TLBIVAL_LOW_2_APPS_ADDR A:0x1e20620
y.create.l HWIO_APPS_SMMU_CB1_TLBIVAL_LOW_2_APPS_ADDR A:0x1e21620
y.create.l HWIO_APPS_SMMU_CB2_TLBIVAL_LOW_2_APPS_ADDR A:0x1e22620
y.create.l HWIO_APPS_SMMU_CB3_TLBIVAL_LOW_2_APPS_ADDR A:0x1e23620
y.create.l HWIO_APPS_SMMU_CB4_TLBIVAL_LOW_2_APPS_ADDR A:0x1e24620
y.create.l HWIO_APPS_SMMU_CB5_TLBIVAL_LOW_2_APPS_ADDR A:0x1e25620
y.create.l HWIO_APPS_SMMU_CB6_TLBIVAL_LOW_2_APPS_ADDR A:0x1e26620
y.create.l HWIO_APPS_SMMU_CB7_TLBIVAL_LOW_2_APPS_ADDR A:0x1e27620
y.create.l HWIO_APPS_SMMU_CB8_TLBIVAL_LOW_2_APPS_ADDR A:0x1e28620
y.create.l HWIO_APPS_SMMU_CB9_TLBIVAL_LOW_2_APPS_ADDR A:0x1e29620
y.create.l HWIO_APPS_SMMU_CB10_TLBIVAL_LOW_2_APPS_ADDR A:0x1e2a620
y.create.l HWIO_APPS_SMMU_CB11_TLBIVAL_LOW_2_APPS_ADDR A:0x1e2b620
y.create.l HWIO_APPS_SMMU_CB12_TLBIVAL_LOW_2_APPS_ADDR A:0x1e2c620
y.create.l HWIO_APPS_SMMU_CB13_TLBIVAL_LOW_2_APPS_ADDR A:0x1e2d620
y.create.l HWIO_APPS_SMMU_CB14_TLBIVAL_LOW_2_APPS_ADDR A:0x1e2e620
y.create.l HWIO_APPS_SMMU_CB15_TLBIVAL_LOW_2_APPS_ADDR A:0x1e2f620
y.create.l HWIO_APPS_SMMU_CB16_TLBIVAL_LOW_2_APPS_ADDR A:0x1e30620
y.create.l HWIO_APPS_SMMU_CB17_TLBIVAL_LOW_2_APPS_ADDR A:0x1e31620
y.create.l HWIO_APPS_SMMU_CB18_TLBIVAL_LOW_2_APPS_ADDR A:0x1e32620
y.create.l HWIO_APPS_SMMU_CB19_TLBIVAL_LOW_2_APPS_ADDR A:0x1e33620
y.create.l HWIO_APPS_SMMU_CB20_TLBIVAL_LOW_2_APPS_ADDR A:0x1e34620
y.create.l HWIO_APPS_SMMU_CB21_TLBIVAL_LOW_2_APPS_ADDR A:0x1e35620
y.create.l HWIO_APPS_SMMU_CB22_TLBIVAL_LOW_2_APPS_ADDR A:0x1e36620
y.create.l HWIO_APPS_SMMU_CB23_TLBIVAL_LOW_2_APPS_ADDR A:0x1e37620
y.create.l HWIO_APPS_SMMU_CB24_TLBIVAL_LOW_2_APPS_ADDR A:0x1e38620
y.create.l HWIO_APPS_SMMU_CB25_TLBIVAL_LOW_2_APPS_ADDR A:0x1e39620
y.create.l HWIO_APPS_SMMU_CB26_TLBIVAL_LOW_2_APPS_ADDR A:0x1e3a620
y.create.l HWIO_APPS_SMMU_CB27_TLBIVAL_LOW_2_APPS_ADDR A:0x1e3b620
y.create.l HWIO_APPS_SMMU_CB28_TLBIVAL_LOW_2_APPS_ADDR A:0x1e3c620
y.create.l HWIO_APPS_SMMU_CB29_TLBIVAL_LOW_2_APPS_ADDR A:0x1e3d620
y.create.l HWIO_APPS_SMMU_CB30_TLBIVAL_LOW_2_APPS_ADDR A:0x1e3e620
y.create.l HWIO_APPS_SMMU_CB31_TLBIVAL_LOW_2_APPS_ADDR A:0x1e3f620
y.create.l HWIO_APPS_SMMU_CB0_TLBIVAL_HIGH_2_APPS_ADDR A:0x1e20624
y.create.l HWIO_APPS_SMMU_CB1_TLBIVAL_HIGH_2_APPS_ADDR A:0x1e21624
y.create.l HWIO_APPS_SMMU_CB2_TLBIVAL_HIGH_2_APPS_ADDR A:0x1e22624
y.create.l HWIO_APPS_SMMU_CB3_TLBIVAL_HIGH_2_APPS_ADDR A:0x1e23624
y.create.l HWIO_APPS_SMMU_CB4_TLBIVAL_HIGH_2_APPS_ADDR A:0x1e24624
y.create.l HWIO_APPS_SMMU_CB5_TLBIVAL_HIGH_2_APPS_ADDR A:0x1e25624
y.create.l HWIO_APPS_SMMU_CB6_TLBIVAL_HIGH_2_APPS_ADDR A:0x1e26624
y.create.l HWIO_APPS_SMMU_CB7_TLBIVAL_HIGH_2_APPS_ADDR A:0x1e27624
y.create.l HWIO_APPS_SMMU_CB8_TLBIVAL_HIGH_2_APPS_ADDR A:0x1e28624
y.create.l HWIO_APPS_SMMU_CB9_TLBIVAL_HIGH_2_APPS_ADDR A:0x1e29624
y.create.l HWIO_APPS_SMMU_CB10_TLBIVAL_HIGH_2_APPS_ADDR A:0x1e2a624
y.create.l HWIO_APPS_SMMU_CB11_TLBIVAL_HIGH_2_APPS_ADDR A:0x1e2b624
y.create.l HWIO_APPS_SMMU_CB12_TLBIVAL_HIGH_2_APPS_ADDR A:0x1e2c624
y.create.l HWIO_APPS_SMMU_CB13_TLBIVAL_HIGH_2_APPS_ADDR A:0x1e2d624
y.create.l HWIO_APPS_SMMU_CB14_TLBIVAL_HIGH_2_APPS_ADDR A:0x1e2e624
y.create.l HWIO_APPS_SMMU_CB15_TLBIVAL_HIGH_2_APPS_ADDR A:0x1e2f624
y.create.l HWIO_APPS_SMMU_CB16_TLBIVAL_HIGH_2_APPS_ADDR A:0x1e30624
y.create.l HWIO_APPS_SMMU_CB17_TLBIVAL_HIGH_2_APPS_ADDR A:0x1e31624
y.create.l HWIO_APPS_SMMU_CB18_TLBIVAL_HIGH_2_APPS_ADDR A:0x1e32624
y.create.l HWIO_APPS_SMMU_CB19_TLBIVAL_HIGH_2_APPS_ADDR A:0x1e33624
y.create.l HWIO_APPS_SMMU_CB20_TLBIVAL_HIGH_2_APPS_ADDR A:0x1e34624
y.create.l HWIO_APPS_SMMU_CB21_TLBIVAL_HIGH_2_APPS_ADDR A:0x1e35624
y.create.l HWIO_APPS_SMMU_CB22_TLBIVAL_HIGH_2_APPS_ADDR A:0x1e36624
y.create.l HWIO_APPS_SMMU_CB23_TLBIVAL_HIGH_2_APPS_ADDR A:0x1e37624
y.create.l HWIO_APPS_SMMU_CB24_TLBIVAL_HIGH_2_APPS_ADDR A:0x1e38624
y.create.l HWIO_APPS_SMMU_CB25_TLBIVAL_HIGH_2_APPS_ADDR A:0x1e39624
y.create.l HWIO_APPS_SMMU_CB26_TLBIVAL_HIGH_2_APPS_ADDR A:0x1e3a624
y.create.l HWIO_APPS_SMMU_CB27_TLBIVAL_HIGH_2_APPS_ADDR A:0x1e3b624
y.create.l HWIO_APPS_SMMU_CB28_TLBIVAL_HIGH_2_APPS_ADDR A:0x1e3c624
y.create.l HWIO_APPS_SMMU_CB29_TLBIVAL_HIGH_2_APPS_ADDR A:0x1e3d624
y.create.l HWIO_APPS_SMMU_CB30_TLBIVAL_HIGH_2_APPS_ADDR A:0x1e3e624
y.create.l HWIO_APPS_SMMU_CB31_TLBIVAL_HIGH_2_APPS_ADDR A:0x1e3f624
y.create.l HWIO_APPS_SMMU_CB0_TLBIVAAL_LOW_2_APPS_ADDR A:0x1e20628
y.create.l HWIO_APPS_SMMU_CB1_TLBIVAAL_LOW_2_APPS_ADDR A:0x1e21628
y.create.l HWIO_APPS_SMMU_CB2_TLBIVAAL_LOW_2_APPS_ADDR A:0x1e22628
y.create.l HWIO_APPS_SMMU_CB3_TLBIVAAL_LOW_2_APPS_ADDR A:0x1e23628
y.create.l HWIO_APPS_SMMU_CB4_TLBIVAAL_LOW_2_APPS_ADDR A:0x1e24628
y.create.l HWIO_APPS_SMMU_CB5_TLBIVAAL_LOW_2_APPS_ADDR A:0x1e25628
y.create.l HWIO_APPS_SMMU_CB6_TLBIVAAL_LOW_2_APPS_ADDR A:0x1e26628
y.create.l HWIO_APPS_SMMU_CB7_TLBIVAAL_LOW_2_APPS_ADDR A:0x1e27628
y.create.l HWIO_APPS_SMMU_CB8_TLBIVAAL_LOW_2_APPS_ADDR A:0x1e28628
y.create.l HWIO_APPS_SMMU_CB9_TLBIVAAL_LOW_2_APPS_ADDR A:0x1e29628
y.create.l HWIO_APPS_SMMU_CB10_TLBIVAAL_LOW_2_APPS_ADDR A:0x1e2a628
y.create.l HWIO_APPS_SMMU_CB11_TLBIVAAL_LOW_2_APPS_ADDR A:0x1e2b628
y.create.l HWIO_APPS_SMMU_CB12_TLBIVAAL_LOW_2_APPS_ADDR A:0x1e2c628
y.create.l HWIO_APPS_SMMU_CB13_TLBIVAAL_LOW_2_APPS_ADDR A:0x1e2d628
y.create.l HWIO_APPS_SMMU_CB14_TLBIVAAL_LOW_2_APPS_ADDR A:0x1e2e628
y.create.l HWIO_APPS_SMMU_CB15_TLBIVAAL_LOW_2_APPS_ADDR A:0x1e2f628
y.create.l HWIO_APPS_SMMU_CB16_TLBIVAAL_LOW_2_APPS_ADDR A:0x1e30628
y.create.l HWIO_APPS_SMMU_CB17_TLBIVAAL_LOW_2_APPS_ADDR A:0x1e31628
y.create.l HWIO_APPS_SMMU_CB18_TLBIVAAL_LOW_2_APPS_ADDR A:0x1e32628
y.create.l HWIO_APPS_SMMU_CB19_TLBIVAAL_LOW_2_APPS_ADDR A:0x1e33628
y.create.l HWIO_APPS_SMMU_CB20_TLBIVAAL_LOW_2_APPS_ADDR A:0x1e34628
y.create.l HWIO_APPS_SMMU_CB21_TLBIVAAL_LOW_2_APPS_ADDR A:0x1e35628
y.create.l HWIO_APPS_SMMU_CB22_TLBIVAAL_LOW_2_APPS_ADDR A:0x1e36628
y.create.l HWIO_APPS_SMMU_CB23_TLBIVAAL_LOW_2_APPS_ADDR A:0x1e37628
y.create.l HWIO_APPS_SMMU_CB24_TLBIVAAL_LOW_2_APPS_ADDR A:0x1e38628
y.create.l HWIO_APPS_SMMU_CB25_TLBIVAAL_LOW_2_APPS_ADDR A:0x1e39628
y.create.l HWIO_APPS_SMMU_CB26_TLBIVAAL_LOW_2_APPS_ADDR A:0x1e3a628
y.create.l HWIO_APPS_SMMU_CB27_TLBIVAAL_LOW_2_APPS_ADDR A:0x1e3b628
y.create.l HWIO_APPS_SMMU_CB28_TLBIVAAL_LOW_2_APPS_ADDR A:0x1e3c628
y.create.l HWIO_APPS_SMMU_CB29_TLBIVAAL_LOW_2_APPS_ADDR A:0x1e3d628
y.create.l HWIO_APPS_SMMU_CB30_TLBIVAAL_LOW_2_APPS_ADDR A:0x1e3e628
y.create.l HWIO_APPS_SMMU_CB31_TLBIVAAL_LOW_2_APPS_ADDR A:0x1e3f628
y.create.l HWIO_APPS_SMMU_CB0_TLBIVAAL_HIGH_2_APPS_ADDR A:0x1e2062c
y.create.l HWIO_APPS_SMMU_CB1_TLBIVAAL_HIGH_2_APPS_ADDR A:0x1e2162c
y.create.l HWIO_APPS_SMMU_CB2_TLBIVAAL_HIGH_2_APPS_ADDR A:0x1e2262c
y.create.l HWIO_APPS_SMMU_CB3_TLBIVAAL_HIGH_2_APPS_ADDR A:0x1e2362c
y.create.l HWIO_APPS_SMMU_CB4_TLBIVAAL_HIGH_2_APPS_ADDR A:0x1e2462c
y.create.l HWIO_APPS_SMMU_CB5_TLBIVAAL_HIGH_2_APPS_ADDR A:0x1e2562c
y.create.l HWIO_APPS_SMMU_CB6_TLBIVAAL_HIGH_2_APPS_ADDR A:0x1e2662c
y.create.l HWIO_APPS_SMMU_CB7_TLBIVAAL_HIGH_2_APPS_ADDR A:0x1e2762c
y.create.l HWIO_APPS_SMMU_CB8_TLBIVAAL_HIGH_2_APPS_ADDR A:0x1e2862c
y.create.l HWIO_APPS_SMMU_CB9_TLBIVAAL_HIGH_2_APPS_ADDR A:0x1e2962c
y.create.l HWIO_APPS_SMMU_CB10_TLBIVAAL_HIGH_2_APPS_ADDR A:0x1e2a62c
y.create.l HWIO_APPS_SMMU_CB11_TLBIVAAL_HIGH_2_APPS_ADDR A:0x1e2b62c
y.create.l HWIO_APPS_SMMU_CB12_TLBIVAAL_HIGH_2_APPS_ADDR A:0x1e2c62c
y.create.l HWIO_APPS_SMMU_CB13_TLBIVAAL_HIGH_2_APPS_ADDR A:0x1e2d62c
y.create.l HWIO_APPS_SMMU_CB14_TLBIVAAL_HIGH_2_APPS_ADDR A:0x1e2e62c
y.create.l HWIO_APPS_SMMU_CB15_TLBIVAAL_HIGH_2_APPS_ADDR A:0x1e2f62c
y.create.l HWIO_APPS_SMMU_CB16_TLBIVAAL_HIGH_2_APPS_ADDR A:0x1e3062c
y.create.l HWIO_APPS_SMMU_CB17_TLBIVAAL_HIGH_2_APPS_ADDR A:0x1e3162c
y.create.l HWIO_APPS_SMMU_CB18_TLBIVAAL_HIGH_2_APPS_ADDR A:0x1e3262c
y.create.l HWIO_APPS_SMMU_CB19_TLBIVAAL_HIGH_2_APPS_ADDR A:0x1e3362c
y.create.l HWIO_APPS_SMMU_CB20_TLBIVAAL_HIGH_2_APPS_ADDR A:0x1e3462c
y.create.l HWIO_APPS_SMMU_CB21_TLBIVAAL_HIGH_2_APPS_ADDR A:0x1e3562c
y.create.l HWIO_APPS_SMMU_CB22_TLBIVAAL_HIGH_2_APPS_ADDR A:0x1e3662c
y.create.l HWIO_APPS_SMMU_CB23_TLBIVAAL_HIGH_2_APPS_ADDR A:0x1e3762c
y.create.l HWIO_APPS_SMMU_CB24_TLBIVAAL_HIGH_2_APPS_ADDR A:0x1e3862c
y.create.l HWIO_APPS_SMMU_CB25_TLBIVAAL_HIGH_2_APPS_ADDR A:0x1e3962c
y.create.l HWIO_APPS_SMMU_CB26_TLBIVAAL_HIGH_2_APPS_ADDR A:0x1e3a62c
y.create.l HWIO_APPS_SMMU_CB27_TLBIVAAL_HIGH_2_APPS_ADDR A:0x1e3b62c
y.create.l HWIO_APPS_SMMU_CB28_TLBIVAAL_HIGH_2_APPS_ADDR A:0x1e3c62c
y.create.l HWIO_APPS_SMMU_CB29_TLBIVAAL_HIGH_2_APPS_ADDR A:0x1e3d62c
y.create.l HWIO_APPS_SMMU_CB30_TLBIVAAL_HIGH_2_APPS_ADDR A:0x1e3e62c
y.create.l HWIO_APPS_SMMU_CB31_TLBIVAAL_HIGH_2_APPS_ADDR A:0x1e3f62c
y.create.l HWIO_APPS_SMMU_CB0_TLBIIPAS2_LOW_2_APPS_ADDR A:0x1e20630
y.create.l HWIO_APPS_SMMU_CB1_TLBIIPAS2_LOW_2_APPS_ADDR A:0x1e21630
y.create.l HWIO_APPS_SMMU_CB2_TLBIIPAS2_LOW_2_APPS_ADDR A:0x1e22630
y.create.l HWIO_APPS_SMMU_CB3_TLBIIPAS2_LOW_2_APPS_ADDR A:0x1e23630
y.create.l HWIO_APPS_SMMU_CB4_TLBIIPAS2_LOW_2_APPS_ADDR A:0x1e24630
y.create.l HWIO_APPS_SMMU_CB5_TLBIIPAS2_LOW_2_APPS_ADDR A:0x1e25630
y.create.l HWIO_APPS_SMMU_CB6_TLBIIPAS2_LOW_2_APPS_ADDR A:0x1e26630
y.create.l HWIO_APPS_SMMU_CB7_TLBIIPAS2_LOW_2_APPS_ADDR A:0x1e27630
y.create.l HWIO_APPS_SMMU_CB8_TLBIIPAS2_LOW_2_APPS_ADDR A:0x1e28630
y.create.l HWIO_APPS_SMMU_CB9_TLBIIPAS2_LOW_2_APPS_ADDR A:0x1e29630
y.create.l HWIO_APPS_SMMU_CB10_TLBIIPAS2_LOW_2_APPS_ADDR A:0x1e2a630
y.create.l HWIO_APPS_SMMU_CB11_TLBIIPAS2_LOW_2_APPS_ADDR A:0x1e2b630
y.create.l HWIO_APPS_SMMU_CB12_TLBIIPAS2_LOW_2_APPS_ADDR A:0x1e2c630
y.create.l HWIO_APPS_SMMU_CB13_TLBIIPAS2_LOW_2_APPS_ADDR A:0x1e2d630
y.create.l HWIO_APPS_SMMU_CB14_TLBIIPAS2_LOW_2_APPS_ADDR A:0x1e2e630
y.create.l HWIO_APPS_SMMU_CB15_TLBIIPAS2_LOW_2_APPS_ADDR A:0x1e2f630
y.create.l HWIO_APPS_SMMU_CB16_TLBIIPAS2_LOW_2_APPS_ADDR A:0x1e30630
y.create.l HWIO_APPS_SMMU_CB17_TLBIIPAS2_LOW_2_APPS_ADDR A:0x1e31630
y.create.l HWIO_APPS_SMMU_CB18_TLBIIPAS2_LOW_2_APPS_ADDR A:0x1e32630
y.create.l HWIO_APPS_SMMU_CB19_TLBIIPAS2_LOW_2_APPS_ADDR A:0x1e33630
y.create.l HWIO_APPS_SMMU_CB20_TLBIIPAS2_LOW_2_APPS_ADDR A:0x1e34630
y.create.l HWIO_APPS_SMMU_CB21_TLBIIPAS2_LOW_2_APPS_ADDR A:0x1e35630
y.create.l HWIO_APPS_SMMU_CB22_TLBIIPAS2_LOW_2_APPS_ADDR A:0x1e36630
y.create.l HWIO_APPS_SMMU_CB23_TLBIIPAS2_LOW_2_APPS_ADDR A:0x1e37630
y.create.l HWIO_APPS_SMMU_CB24_TLBIIPAS2_LOW_2_APPS_ADDR A:0x1e38630
y.create.l HWIO_APPS_SMMU_CB25_TLBIIPAS2_LOW_2_APPS_ADDR A:0x1e39630
y.create.l HWIO_APPS_SMMU_CB26_TLBIIPAS2_LOW_2_APPS_ADDR A:0x1e3a630
y.create.l HWIO_APPS_SMMU_CB27_TLBIIPAS2_LOW_2_APPS_ADDR A:0x1e3b630
y.create.l HWIO_APPS_SMMU_CB28_TLBIIPAS2_LOW_2_APPS_ADDR A:0x1e3c630
y.create.l HWIO_APPS_SMMU_CB29_TLBIIPAS2_LOW_2_APPS_ADDR A:0x1e3d630
y.create.l HWIO_APPS_SMMU_CB30_TLBIIPAS2_LOW_2_APPS_ADDR A:0x1e3e630
y.create.l HWIO_APPS_SMMU_CB31_TLBIIPAS2_LOW_2_APPS_ADDR A:0x1e3f630
y.create.l HWIO_APPS_SMMU_CB0_TLBIIPAS2_HIGH_2_APPS_ADDR A:0x1e20634
y.create.l HWIO_APPS_SMMU_CB1_TLBIIPAS2_HIGH_2_APPS_ADDR A:0x1e21634
y.create.l HWIO_APPS_SMMU_CB2_TLBIIPAS2_HIGH_2_APPS_ADDR A:0x1e22634
y.create.l HWIO_APPS_SMMU_CB3_TLBIIPAS2_HIGH_2_APPS_ADDR A:0x1e23634
y.create.l HWIO_APPS_SMMU_CB4_TLBIIPAS2_HIGH_2_APPS_ADDR A:0x1e24634
y.create.l HWIO_APPS_SMMU_CB5_TLBIIPAS2_HIGH_2_APPS_ADDR A:0x1e25634
y.create.l HWIO_APPS_SMMU_CB6_TLBIIPAS2_HIGH_2_APPS_ADDR A:0x1e26634
y.create.l HWIO_APPS_SMMU_CB7_TLBIIPAS2_HIGH_2_APPS_ADDR A:0x1e27634
y.create.l HWIO_APPS_SMMU_CB8_TLBIIPAS2_HIGH_2_APPS_ADDR A:0x1e28634
y.create.l HWIO_APPS_SMMU_CB9_TLBIIPAS2_HIGH_2_APPS_ADDR A:0x1e29634
y.create.l HWIO_APPS_SMMU_CB10_TLBIIPAS2_HIGH_2_APPS_ADDR A:0x1e2a634
y.create.l HWIO_APPS_SMMU_CB11_TLBIIPAS2_HIGH_2_APPS_ADDR A:0x1e2b634
y.create.l HWIO_APPS_SMMU_CB12_TLBIIPAS2_HIGH_2_APPS_ADDR A:0x1e2c634
y.create.l HWIO_APPS_SMMU_CB13_TLBIIPAS2_HIGH_2_APPS_ADDR A:0x1e2d634
y.create.l HWIO_APPS_SMMU_CB14_TLBIIPAS2_HIGH_2_APPS_ADDR A:0x1e2e634
y.create.l HWIO_APPS_SMMU_CB15_TLBIIPAS2_HIGH_2_APPS_ADDR A:0x1e2f634
y.create.l HWIO_APPS_SMMU_CB16_TLBIIPAS2_HIGH_2_APPS_ADDR A:0x1e30634
y.create.l HWIO_APPS_SMMU_CB17_TLBIIPAS2_HIGH_2_APPS_ADDR A:0x1e31634
y.create.l HWIO_APPS_SMMU_CB18_TLBIIPAS2_HIGH_2_APPS_ADDR A:0x1e32634
y.create.l HWIO_APPS_SMMU_CB19_TLBIIPAS2_HIGH_2_APPS_ADDR A:0x1e33634
y.create.l HWIO_APPS_SMMU_CB20_TLBIIPAS2_HIGH_2_APPS_ADDR A:0x1e34634
y.create.l HWIO_APPS_SMMU_CB21_TLBIIPAS2_HIGH_2_APPS_ADDR A:0x1e35634
y.create.l HWIO_APPS_SMMU_CB22_TLBIIPAS2_HIGH_2_APPS_ADDR A:0x1e36634
y.create.l HWIO_APPS_SMMU_CB23_TLBIIPAS2_HIGH_2_APPS_ADDR A:0x1e37634
y.create.l HWIO_APPS_SMMU_CB24_TLBIIPAS2_HIGH_2_APPS_ADDR A:0x1e38634
y.create.l HWIO_APPS_SMMU_CB25_TLBIIPAS2_HIGH_2_APPS_ADDR A:0x1e39634
y.create.l HWIO_APPS_SMMU_CB26_TLBIIPAS2_HIGH_2_APPS_ADDR A:0x1e3a634
y.create.l HWIO_APPS_SMMU_CB27_TLBIIPAS2_HIGH_2_APPS_ADDR A:0x1e3b634
y.create.l HWIO_APPS_SMMU_CB28_TLBIIPAS2_HIGH_2_APPS_ADDR A:0x1e3c634
y.create.l HWIO_APPS_SMMU_CB29_TLBIIPAS2_HIGH_2_APPS_ADDR A:0x1e3d634
y.create.l HWIO_APPS_SMMU_CB30_TLBIIPAS2_HIGH_2_APPS_ADDR A:0x1e3e634
y.create.l HWIO_APPS_SMMU_CB31_TLBIIPAS2_HIGH_2_APPS_ADDR A:0x1e3f634
y.create.l HWIO_APPS_SMMU_CB0_TLBIIPAS2L_LOW_2_APPS_ADDR A:0x1e20638
y.create.l HWIO_APPS_SMMU_CB1_TLBIIPAS2L_LOW_2_APPS_ADDR A:0x1e21638
y.create.l HWIO_APPS_SMMU_CB2_TLBIIPAS2L_LOW_2_APPS_ADDR A:0x1e22638
y.create.l HWIO_APPS_SMMU_CB3_TLBIIPAS2L_LOW_2_APPS_ADDR A:0x1e23638
y.create.l HWIO_APPS_SMMU_CB4_TLBIIPAS2L_LOW_2_APPS_ADDR A:0x1e24638
y.create.l HWIO_APPS_SMMU_CB5_TLBIIPAS2L_LOW_2_APPS_ADDR A:0x1e25638
y.create.l HWIO_APPS_SMMU_CB6_TLBIIPAS2L_LOW_2_APPS_ADDR A:0x1e26638
y.create.l HWIO_APPS_SMMU_CB7_TLBIIPAS2L_LOW_2_APPS_ADDR A:0x1e27638
y.create.l HWIO_APPS_SMMU_CB8_TLBIIPAS2L_LOW_2_APPS_ADDR A:0x1e28638
y.create.l HWIO_APPS_SMMU_CB9_TLBIIPAS2L_LOW_2_APPS_ADDR A:0x1e29638
y.create.l HWIO_APPS_SMMU_CB10_TLBIIPAS2L_LOW_2_APPS_ADDR A:0x1e2a638
y.create.l HWIO_APPS_SMMU_CB11_TLBIIPAS2L_LOW_2_APPS_ADDR A:0x1e2b638
y.create.l HWIO_APPS_SMMU_CB12_TLBIIPAS2L_LOW_2_APPS_ADDR A:0x1e2c638
y.create.l HWIO_APPS_SMMU_CB13_TLBIIPAS2L_LOW_2_APPS_ADDR A:0x1e2d638
y.create.l HWIO_APPS_SMMU_CB14_TLBIIPAS2L_LOW_2_APPS_ADDR A:0x1e2e638
y.create.l HWIO_APPS_SMMU_CB15_TLBIIPAS2L_LOW_2_APPS_ADDR A:0x1e2f638
y.create.l HWIO_APPS_SMMU_CB16_TLBIIPAS2L_LOW_2_APPS_ADDR A:0x1e30638
y.create.l HWIO_APPS_SMMU_CB17_TLBIIPAS2L_LOW_2_APPS_ADDR A:0x1e31638
y.create.l HWIO_APPS_SMMU_CB18_TLBIIPAS2L_LOW_2_APPS_ADDR A:0x1e32638
y.create.l HWIO_APPS_SMMU_CB19_TLBIIPAS2L_LOW_2_APPS_ADDR A:0x1e33638
y.create.l HWIO_APPS_SMMU_CB20_TLBIIPAS2L_LOW_2_APPS_ADDR A:0x1e34638
y.create.l HWIO_APPS_SMMU_CB21_TLBIIPAS2L_LOW_2_APPS_ADDR A:0x1e35638
y.create.l HWIO_APPS_SMMU_CB22_TLBIIPAS2L_LOW_2_APPS_ADDR A:0x1e36638
y.create.l HWIO_APPS_SMMU_CB23_TLBIIPAS2L_LOW_2_APPS_ADDR A:0x1e37638
y.create.l HWIO_APPS_SMMU_CB24_TLBIIPAS2L_LOW_2_APPS_ADDR A:0x1e38638
y.create.l HWIO_APPS_SMMU_CB25_TLBIIPAS2L_LOW_2_APPS_ADDR A:0x1e39638
y.create.l HWIO_APPS_SMMU_CB26_TLBIIPAS2L_LOW_2_APPS_ADDR A:0x1e3a638
y.create.l HWIO_APPS_SMMU_CB27_TLBIIPAS2L_LOW_2_APPS_ADDR A:0x1e3b638
y.create.l HWIO_APPS_SMMU_CB28_TLBIIPAS2L_LOW_2_APPS_ADDR A:0x1e3c638
y.create.l HWIO_APPS_SMMU_CB29_TLBIIPAS2L_LOW_2_APPS_ADDR A:0x1e3d638
y.create.l HWIO_APPS_SMMU_CB30_TLBIIPAS2L_LOW_2_APPS_ADDR A:0x1e3e638
y.create.l HWIO_APPS_SMMU_CB31_TLBIIPAS2L_LOW_2_APPS_ADDR A:0x1e3f638
y.create.l HWIO_APPS_SMMU_CB0_TLBIIPAS2L_HIGH_2_APPS_ADDR A:0x1e2063c
y.create.l HWIO_APPS_SMMU_CB1_TLBIIPAS2L_HIGH_2_APPS_ADDR A:0x1e2163c
y.create.l HWIO_APPS_SMMU_CB2_TLBIIPAS2L_HIGH_2_APPS_ADDR A:0x1e2263c
y.create.l HWIO_APPS_SMMU_CB3_TLBIIPAS2L_HIGH_2_APPS_ADDR A:0x1e2363c
y.create.l HWIO_APPS_SMMU_CB4_TLBIIPAS2L_HIGH_2_APPS_ADDR A:0x1e2463c
y.create.l HWIO_APPS_SMMU_CB5_TLBIIPAS2L_HIGH_2_APPS_ADDR A:0x1e2563c
y.create.l HWIO_APPS_SMMU_CB6_TLBIIPAS2L_HIGH_2_APPS_ADDR A:0x1e2663c
y.create.l HWIO_APPS_SMMU_CB7_TLBIIPAS2L_HIGH_2_APPS_ADDR A:0x1e2763c
y.create.l HWIO_APPS_SMMU_CB8_TLBIIPAS2L_HIGH_2_APPS_ADDR A:0x1e2863c
y.create.l HWIO_APPS_SMMU_CB9_TLBIIPAS2L_HIGH_2_APPS_ADDR A:0x1e2963c
y.create.l HWIO_APPS_SMMU_CB10_TLBIIPAS2L_HIGH_2_APPS_ADDR A:0x1e2a63c
y.create.l HWIO_APPS_SMMU_CB11_TLBIIPAS2L_HIGH_2_APPS_ADDR A:0x1e2b63c
y.create.l HWIO_APPS_SMMU_CB12_TLBIIPAS2L_HIGH_2_APPS_ADDR A:0x1e2c63c
y.create.l HWIO_APPS_SMMU_CB13_TLBIIPAS2L_HIGH_2_APPS_ADDR A:0x1e2d63c
y.create.l HWIO_APPS_SMMU_CB14_TLBIIPAS2L_HIGH_2_APPS_ADDR A:0x1e2e63c
y.create.l HWIO_APPS_SMMU_CB15_TLBIIPAS2L_HIGH_2_APPS_ADDR A:0x1e2f63c
y.create.l HWIO_APPS_SMMU_CB16_TLBIIPAS2L_HIGH_2_APPS_ADDR A:0x1e3063c
y.create.l HWIO_APPS_SMMU_CB17_TLBIIPAS2L_HIGH_2_APPS_ADDR A:0x1e3163c
y.create.l HWIO_APPS_SMMU_CB18_TLBIIPAS2L_HIGH_2_APPS_ADDR A:0x1e3263c
y.create.l HWIO_APPS_SMMU_CB19_TLBIIPAS2L_HIGH_2_APPS_ADDR A:0x1e3363c
y.create.l HWIO_APPS_SMMU_CB20_TLBIIPAS2L_HIGH_2_APPS_ADDR A:0x1e3463c
y.create.l HWIO_APPS_SMMU_CB21_TLBIIPAS2L_HIGH_2_APPS_ADDR A:0x1e3563c
y.create.l HWIO_APPS_SMMU_CB22_TLBIIPAS2L_HIGH_2_APPS_ADDR A:0x1e3663c
y.create.l HWIO_APPS_SMMU_CB23_TLBIIPAS2L_HIGH_2_APPS_ADDR A:0x1e3763c
y.create.l HWIO_APPS_SMMU_CB24_TLBIIPAS2L_HIGH_2_APPS_ADDR A:0x1e3863c
y.create.l HWIO_APPS_SMMU_CB25_TLBIIPAS2L_HIGH_2_APPS_ADDR A:0x1e3963c
y.create.l HWIO_APPS_SMMU_CB26_TLBIIPAS2L_HIGH_2_APPS_ADDR A:0x1e3a63c
y.create.l HWIO_APPS_SMMU_CB27_TLBIIPAS2L_HIGH_2_APPS_ADDR A:0x1e3b63c
y.create.l HWIO_APPS_SMMU_CB28_TLBIIPAS2L_HIGH_2_APPS_ADDR A:0x1e3c63c
y.create.l HWIO_APPS_SMMU_CB29_TLBIIPAS2L_HIGH_2_APPS_ADDR A:0x1e3d63c
y.create.l HWIO_APPS_SMMU_CB30_TLBIIPAS2L_HIGH_2_APPS_ADDR A:0x1e3e63c
y.create.l HWIO_APPS_SMMU_CB31_TLBIIPAS2L_HIGH_2_APPS_ADDR A:0x1e3f63c
y.create.l HWIO_APPS_SMMU_CB0_TLBSYNC_2_APPS_ADDR A:0x1e207f0
y.create.l HWIO_APPS_SMMU_CB1_TLBSYNC_2_APPS_ADDR A:0x1e217f0
y.create.l HWIO_APPS_SMMU_CB2_TLBSYNC_2_APPS_ADDR A:0x1e227f0
y.create.l HWIO_APPS_SMMU_CB3_TLBSYNC_2_APPS_ADDR A:0x1e237f0
y.create.l HWIO_APPS_SMMU_CB4_TLBSYNC_2_APPS_ADDR A:0x1e247f0
y.create.l HWIO_APPS_SMMU_CB5_TLBSYNC_2_APPS_ADDR A:0x1e257f0
y.create.l HWIO_APPS_SMMU_CB6_TLBSYNC_2_APPS_ADDR A:0x1e267f0
y.create.l HWIO_APPS_SMMU_CB7_TLBSYNC_2_APPS_ADDR A:0x1e277f0
y.create.l HWIO_APPS_SMMU_CB8_TLBSYNC_2_APPS_ADDR A:0x1e287f0
y.create.l HWIO_APPS_SMMU_CB9_TLBSYNC_2_APPS_ADDR A:0x1e297f0
y.create.l HWIO_APPS_SMMU_CB10_TLBSYNC_2_APPS_ADDR A:0x1e2a7f0
y.create.l HWIO_APPS_SMMU_CB11_TLBSYNC_2_APPS_ADDR A:0x1e2b7f0
y.create.l HWIO_APPS_SMMU_CB12_TLBSYNC_2_APPS_ADDR A:0x1e2c7f0
y.create.l HWIO_APPS_SMMU_CB13_TLBSYNC_2_APPS_ADDR A:0x1e2d7f0
y.create.l HWIO_APPS_SMMU_CB14_TLBSYNC_2_APPS_ADDR A:0x1e2e7f0
y.create.l HWIO_APPS_SMMU_CB15_TLBSYNC_2_APPS_ADDR A:0x1e2f7f0
y.create.l HWIO_APPS_SMMU_CB16_TLBSYNC_2_APPS_ADDR A:0x1e307f0
y.create.l HWIO_APPS_SMMU_CB17_TLBSYNC_2_APPS_ADDR A:0x1e317f0
y.create.l HWIO_APPS_SMMU_CB18_TLBSYNC_2_APPS_ADDR A:0x1e327f0
y.create.l HWIO_APPS_SMMU_CB19_TLBSYNC_2_APPS_ADDR A:0x1e337f0
y.create.l HWIO_APPS_SMMU_CB20_TLBSYNC_2_APPS_ADDR A:0x1e347f0
y.create.l HWIO_APPS_SMMU_CB21_TLBSYNC_2_APPS_ADDR A:0x1e357f0
y.create.l HWIO_APPS_SMMU_CB22_TLBSYNC_2_APPS_ADDR A:0x1e367f0
y.create.l HWIO_APPS_SMMU_CB23_TLBSYNC_2_APPS_ADDR A:0x1e377f0
y.create.l HWIO_APPS_SMMU_CB24_TLBSYNC_2_APPS_ADDR A:0x1e387f0
y.create.l HWIO_APPS_SMMU_CB25_TLBSYNC_2_APPS_ADDR A:0x1e397f0
y.create.l HWIO_APPS_SMMU_CB26_TLBSYNC_2_APPS_ADDR A:0x1e3a7f0
y.create.l HWIO_APPS_SMMU_CB27_TLBSYNC_2_APPS_ADDR A:0x1e3b7f0
y.create.l HWIO_APPS_SMMU_CB28_TLBSYNC_2_APPS_ADDR A:0x1e3c7f0
y.create.l HWIO_APPS_SMMU_CB29_TLBSYNC_2_APPS_ADDR A:0x1e3d7f0
y.create.l HWIO_APPS_SMMU_CB30_TLBSYNC_2_APPS_ADDR A:0x1e3e7f0
y.create.l HWIO_APPS_SMMU_CB31_TLBSYNC_2_APPS_ADDR A:0x1e3f7f0
y.create.l HWIO_APPS_SMMU_CB0_TLBSTATUS_2_APPS_ADDR A:0x1e207f4
y.create.l HWIO_APPS_SMMU_CB1_TLBSTATUS_2_APPS_ADDR A:0x1e217f4
y.create.l HWIO_APPS_SMMU_CB2_TLBSTATUS_2_APPS_ADDR A:0x1e227f4
y.create.l HWIO_APPS_SMMU_CB3_TLBSTATUS_2_APPS_ADDR A:0x1e237f4
y.create.l HWIO_APPS_SMMU_CB4_TLBSTATUS_2_APPS_ADDR A:0x1e247f4
y.create.l HWIO_APPS_SMMU_CB5_TLBSTATUS_2_APPS_ADDR A:0x1e257f4
y.create.l HWIO_APPS_SMMU_CB6_TLBSTATUS_2_APPS_ADDR A:0x1e267f4
y.create.l HWIO_APPS_SMMU_CB7_TLBSTATUS_2_APPS_ADDR A:0x1e277f4
y.create.l HWIO_APPS_SMMU_CB8_TLBSTATUS_2_APPS_ADDR A:0x1e287f4
y.create.l HWIO_APPS_SMMU_CB9_TLBSTATUS_2_APPS_ADDR A:0x1e297f4
y.create.l HWIO_APPS_SMMU_CB10_TLBSTATUS_2_APPS_ADDR A:0x1e2a7f4
y.create.l HWIO_APPS_SMMU_CB11_TLBSTATUS_2_APPS_ADDR A:0x1e2b7f4
y.create.l HWIO_APPS_SMMU_CB12_TLBSTATUS_2_APPS_ADDR A:0x1e2c7f4
y.create.l HWIO_APPS_SMMU_CB13_TLBSTATUS_2_APPS_ADDR A:0x1e2d7f4
y.create.l HWIO_APPS_SMMU_CB14_TLBSTATUS_2_APPS_ADDR A:0x1e2e7f4
y.create.l HWIO_APPS_SMMU_CB15_TLBSTATUS_2_APPS_ADDR A:0x1e2f7f4
y.create.l HWIO_APPS_SMMU_CB16_TLBSTATUS_2_APPS_ADDR A:0x1e307f4
y.create.l HWIO_APPS_SMMU_CB17_TLBSTATUS_2_APPS_ADDR A:0x1e317f4
y.create.l HWIO_APPS_SMMU_CB18_TLBSTATUS_2_APPS_ADDR A:0x1e327f4
y.create.l HWIO_APPS_SMMU_CB19_TLBSTATUS_2_APPS_ADDR A:0x1e337f4
y.create.l HWIO_APPS_SMMU_CB20_TLBSTATUS_2_APPS_ADDR A:0x1e347f4
y.create.l HWIO_APPS_SMMU_CB21_TLBSTATUS_2_APPS_ADDR A:0x1e357f4
y.create.l HWIO_APPS_SMMU_CB22_TLBSTATUS_2_APPS_ADDR A:0x1e367f4
y.create.l HWIO_APPS_SMMU_CB23_TLBSTATUS_2_APPS_ADDR A:0x1e377f4
y.create.l HWIO_APPS_SMMU_CB24_TLBSTATUS_2_APPS_ADDR A:0x1e387f4
y.create.l HWIO_APPS_SMMU_CB25_TLBSTATUS_2_APPS_ADDR A:0x1e397f4
y.create.l HWIO_APPS_SMMU_CB26_TLBSTATUS_2_APPS_ADDR A:0x1e3a7f4
y.create.l HWIO_APPS_SMMU_CB27_TLBSTATUS_2_APPS_ADDR A:0x1e3b7f4
y.create.l HWIO_APPS_SMMU_CB28_TLBSTATUS_2_APPS_ADDR A:0x1e3c7f4
y.create.l HWIO_APPS_SMMU_CB29_TLBSTATUS_2_APPS_ADDR A:0x1e3d7f4
y.create.l HWIO_APPS_SMMU_CB30_TLBSTATUS_2_APPS_ADDR A:0x1e3e7f4
y.create.l HWIO_APPS_SMMU_CB31_TLBSTATUS_2_APPS_ADDR A:0x1e3f7f4
y.create.l HWIO_APPS_SMMU_CB0_PMEVCNTR0_2_APPS_ADDR A:0x1e20e00
y.create.l HWIO_APPS_SMMU_CB1_PMEVCNTR0_2_APPS_ADDR A:0x1e21e00
y.create.l HWIO_APPS_SMMU_CB2_PMEVCNTR0_2_APPS_ADDR A:0x1e22e00
y.create.l HWIO_APPS_SMMU_CB3_PMEVCNTR0_2_APPS_ADDR A:0x1e23e00
y.create.l HWIO_APPS_SMMU_CB4_PMEVCNTR0_2_APPS_ADDR A:0x1e24e00
y.create.l HWIO_APPS_SMMU_CB5_PMEVCNTR0_2_APPS_ADDR A:0x1e25e00
y.create.l HWIO_APPS_SMMU_CB6_PMEVCNTR0_2_APPS_ADDR A:0x1e26e00
y.create.l HWIO_APPS_SMMU_CB7_PMEVCNTR0_2_APPS_ADDR A:0x1e27e00
y.create.l HWIO_APPS_SMMU_CB8_PMEVCNTR0_2_APPS_ADDR A:0x1e28e00
y.create.l HWIO_APPS_SMMU_CB9_PMEVCNTR0_2_APPS_ADDR A:0x1e29e00
y.create.l HWIO_APPS_SMMU_CB10_PMEVCNTR0_2_APPS_ADDR A:0x1e2ae00
y.create.l HWIO_APPS_SMMU_CB11_PMEVCNTR0_2_APPS_ADDR A:0x1e2be00
y.create.l HWIO_APPS_SMMU_CB12_PMEVCNTR0_2_APPS_ADDR A:0x1e2ce00
y.create.l HWIO_APPS_SMMU_CB13_PMEVCNTR0_2_APPS_ADDR A:0x1e2de00
y.create.l HWIO_APPS_SMMU_CB14_PMEVCNTR0_2_APPS_ADDR A:0x1e2ee00
y.create.l HWIO_APPS_SMMU_CB15_PMEVCNTR0_2_APPS_ADDR A:0x1e2fe00
y.create.l HWIO_APPS_SMMU_CB16_PMEVCNTR0_2_APPS_ADDR A:0x1e30e00
y.create.l HWIO_APPS_SMMU_CB17_PMEVCNTR0_2_APPS_ADDR A:0x1e31e00
y.create.l HWIO_APPS_SMMU_CB18_PMEVCNTR0_2_APPS_ADDR A:0x1e32e00
y.create.l HWIO_APPS_SMMU_CB19_PMEVCNTR0_2_APPS_ADDR A:0x1e33e00
y.create.l HWIO_APPS_SMMU_CB20_PMEVCNTR0_2_APPS_ADDR A:0x1e34e00
y.create.l HWIO_APPS_SMMU_CB21_PMEVCNTR0_2_APPS_ADDR A:0x1e35e00
y.create.l HWIO_APPS_SMMU_CB22_PMEVCNTR0_2_APPS_ADDR A:0x1e36e00
y.create.l HWIO_APPS_SMMU_CB23_PMEVCNTR0_2_APPS_ADDR A:0x1e37e00
y.create.l HWIO_APPS_SMMU_CB24_PMEVCNTR0_2_APPS_ADDR A:0x1e38e00
y.create.l HWIO_APPS_SMMU_CB25_PMEVCNTR0_2_APPS_ADDR A:0x1e39e00
y.create.l HWIO_APPS_SMMU_CB26_PMEVCNTR0_2_APPS_ADDR A:0x1e3ae00
y.create.l HWIO_APPS_SMMU_CB27_PMEVCNTR0_2_APPS_ADDR A:0x1e3be00
y.create.l HWIO_APPS_SMMU_CB28_PMEVCNTR0_2_APPS_ADDR A:0x1e3ce00
y.create.l HWIO_APPS_SMMU_CB29_PMEVCNTR0_2_APPS_ADDR A:0x1e3de00
y.create.l HWIO_APPS_SMMU_CB30_PMEVCNTR0_2_APPS_ADDR A:0x1e3ee00
y.create.l HWIO_APPS_SMMU_CB31_PMEVCNTR0_2_APPS_ADDR A:0x1e3fe00
y.create.l HWIO_APPS_SMMU_CB0_PMEVCNTR1_2_APPS_ADDR A:0x1e20e04
y.create.l HWIO_APPS_SMMU_CB1_PMEVCNTR1_2_APPS_ADDR A:0x1e21e04
y.create.l HWIO_APPS_SMMU_CB2_PMEVCNTR1_2_APPS_ADDR A:0x1e22e04
y.create.l HWIO_APPS_SMMU_CB3_PMEVCNTR1_2_APPS_ADDR A:0x1e23e04
y.create.l HWIO_APPS_SMMU_CB4_PMEVCNTR1_2_APPS_ADDR A:0x1e24e04
y.create.l HWIO_APPS_SMMU_CB5_PMEVCNTR1_2_APPS_ADDR A:0x1e25e04
y.create.l HWIO_APPS_SMMU_CB6_PMEVCNTR1_2_APPS_ADDR A:0x1e26e04
y.create.l HWIO_APPS_SMMU_CB7_PMEVCNTR1_2_APPS_ADDR A:0x1e27e04
y.create.l HWIO_APPS_SMMU_CB8_PMEVCNTR1_2_APPS_ADDR A:0x1e28e04
y.create.l HWIO_APPS_SMMU_CB9_PMEVCNTR1_2_APPS_ADDR A:0x1e29e04
y.create.l HWIO_APPS_SMMU_CB10_PMEVCNTR1_2_APPS_ADDR A:0x1e2ae04
y.create.l HWIO_APPS_SMMU_CB11_PMEVCNTR1_2_APPS_ADDR A:0x1e2be04
y.create.l HWIO_APPS_SMMU_CB12_PMEVCNTR1_2_APPS_ADDR A:0x1e2ce04
y.create.l HWIO_APPS_SMMU_CB13_PMEVCNTR1_2_APPS_ADDR A:0x1e2de04
y.create.l HWIO_APPS_SMMU_CB14_PMEVCNTR1_2_APPS_ADDR A:0x1e2ee04
y.create.l HWIO_APPS_SMMU_CB15_PMEVCNTR1_2_APPS_ADDR A:0x1e2fe04
y.create.l HWIO_APPS_SMMU_CB16_PMEVCNTR1_2_APPS_ADDR A:0x1e30e04
y.create.l HWIO_APPS_SMMU_CB17_PMEVCNTR1_2_APPS_ADDR A:0x1e31e04
y.create.l HWIO_APPS_SMMU_CB18_PMEVCNTR1_2_APPS_ADDR A:0x1e32e04
y.create.l HWIO_APPS_SMMU_CB19_PMEVCNTR1_2_APPS_ADDR A:0x1e33e04
y.create.l HWIO_APPS_SMMU_CB20_PMEVCNTR1_2_APPS_ADDR A:0x1e34e04
y.create.l HWIO_APPS_SMMU_CB21_PMEVCNTR1_2_APPS_ADDR A:0x1e35e04
y.create.l HWIO_APPS_SMMU_CB22_PMEVCNTR1_2_APPS_ADDR A:0x1e36e04
y.create.l HWIO_APPS_SMMU_CB23_PMEVCNTR1_2_APPS_ADDR A:0x1e37e04
y.create.l HWIO_APPS_SMMU_CB24_PMEVCNTR1_2_APPS_ADDR A:0x1e38e04
y.create.l HWIO_APPS_SMMU_CB25_PMEVCNTR1_2_APPS_ADDR A:0x1e39e04
y.create.l HWIO_APPS_SMMU_CB26_PMEVCNTR1_2_APPS_ADDR A:0x1e3ae04
y.create.l HWIO_APPS_SMMU_CB27_PMEVCNTR1_2_APPS_ADDR A:0x1e3be04
y.create.l HWIO_APPS_SMMU_CB28_PMEVCNTR1_2_APPS_ADDR A:0x1e3ce04
y.create.l HWIO_APPS_SMMU_CB29_PMEVCNTR1_2_APPS_ADDR A:0x1e3de04
y.create.l HWIO_APPS_SMMU_CB30_PMEVCNTR1_2_APPS_ADDR A:0x1e3ee04
y.create.l HWIO_APPS_SMMU_CB31_PMEVCNTR1_2_APPS_ADDR A:0x1e3fe04
y.create.l HWIO_APPS_SMMU_CB0_PMEVCNTR2_2_APPS_ADDR A:0x1e20e08
y.create.l HWIO_APPS_SMMU_CB1_PMEVCNTR2_2_APPS_ADDR A:0x1e21e08
y.create.l HWIO_APPS_SMMU_CB2_PMEVCNTR2_2_APPS_ADDR A:0x1e22e08
y.create.l HWIO_APPS_SMMU_CB3_PMEVCNTR2_2_APPS_ADDR A:0x1e23e08
y.create.l HWIO_APPS_SMMU_CB4_PMEVCNTR2_2_APPS_ADDR A:0x1e24e08
y.create.l HWIO_APPS_SMMU_CB5_PMEVCNTR2_2_APPS_ADDR A:0x1e25e08
y.create.l HWIO_APPS_SMMU_CB6_PMEVCNTR2_2_APPS_ADDR A:0x1e26e08
y.create.l HWIO_APPS_SMMU_CB7_PMEVCNTR2_2_APPS_ADDR A:0x1e27e08
y.create.l HWIO_APPS_SMMU_CB8_PMEVCNTR2_2_APPS_ADDR A:0x1e28e08
y.create.l HWIO_APPS_SMMU_CB9_PMEVCNTR2_2_APPS_ADDR A:0x1e29e08
y.create.l HWIO_APPS_SMMU_CB10_PMEVCNTR2_2_APPS_ADDR A:0x1e2ae08
y.create.l HWIO_APPS_SMMU_CB11_PMEVCNTR2_2_APPS_ADDR A:0x1e2be08
y.create.l HWIO_APPS_SMMU_CB12_PMEVCNTR2_2_APPS_ADDR A:0x1e2ce08
y.create.l HWIO_APPS_SMMU_CB13_PMEVCNTR2_2_APPS_ADDR A:0x1e2de08
y.create.l HWIO_APPS_SMMU_CB14_PMEVCNTR2_2_APPS_ADDR A:0x1e2ee08
y.create.l HWIO_APPS_SMMU_CB15_PMEVCNTR2_2_APPS_ADDR A:0x1e2fe08
y.create.l HWIO_APPS_SMMU_CB16_PMEVCNTR2_2_APPS_ADDR A:0x1e30e08
y.create.l HWIO_APPS_SMMU_CB17_PMEVCNTR2_2_APPS_ADDR A:0x1e31e08
y.create.l HWIO_APPS_SMMU_CB18_PMEVCNTR2_2_APPS_ADDR A:0x1e32e08
y.create.l HWIO_APPS_SMMU_CB19_PMEVCNTR2_2_APPS_ADDR A:0x1e33e08
y.create.l HWIO_APPS_SMMU_CB20_PMEVCNTR2_2_APPS_ADDR A:0x1e34e08
y.create.l HWIO_APPS_SMMU_CB21_PMEVCNTR2_2_APPS_ADDR A:0x1e35e08
y.create.l HWIO_APPS_SMMU_CB22_PMEVCNTR2_2_APPS_ADDR A:0x1e36e08
y.create.l HWIO_APPS_SMMU_CB23_PMEVCNTR2_2_APPS_ADDR A:0x1e37e08
y.create.l HWIO_APPS_SMMU_CB24_PMEVCNTR2_2_APPS_ADDR A:0x1e38e08
y.create.l HWIO_APPS_SMMU_CB25_PMEVCNTR2_2_APPS_ADDR A:0x1e39e08
y.create.l HWIO_APPS_SMMU_CB26_PMEVCNTR2_2_APPS_ADDR A:0x1e3ae08
y.create.l HWIO_APPS_SMMU_CB27_PMEVCNTR2_2_APPS_ADDR A:0x1e3be08
y.create.l HWIO_APPS_SMMU_CB28_PMEVCNTR2_2_APPS_ADDR A:0x1e3ce08
y.create.l HWIO_APPS_SMMU_CB29_PMEVCNTR2_2_APPS_ADDR A:0x1e3de08
y.create.l HWIO_APPS_SMMU_CB30_PMEVCNTR2_2_APPS_ADDR A:0x1e3ee08
y.create.l HWIO_APPS_SMMU_CB31_PMEVCNTR2_2_APPS_ADDR A:0x1e3fe08
y.create.l HWIO_APPS_SMMU_CB0_PMEVCNTR3_2_APPS_ADDR A:0x1e20e0c
y.create.l HWIO_APPS_SMMU_CB1_PMEVCNTR3_2_APPS_ADDR A:0x1e21e0c
y.create.l HWIO_APPS_SMMU_CB2_PMEVCNTR3_2_APPS_ADDR A:0x1e22e0c
y.create.l HWIO_APPS_SMMU_CB3_PMEVCNTR3_2_APPS_ADDR A:0x1e23e0c
y.create.l HWIO_APPS_SMMU_CB4_PMEVCNTR3_2_APPS_ADDR A:0x1e24e0c
y.create.l HWIO_APPS_SMMU_CB5_PMEVCNTR3_2_APPS_ADDR A:0x1e25e0c
y.create.l HWIO_APPS_SMMU_CB6_PMEVCNTR3_2_APPS_ADDR A:0x1e26e0c
y.create.l HWIO_APPS_SMMU_CB7_PMEVCNTR3_2_APPS_ADDR A:0x1e27e0c
y.create.l HWIO_APPS_SMMU_CB8_PMEVCNTR3_2_APPS_ADDR A:0x1e28e0c
y.create.l HWIO_APPS_SMMU_CB9_PMEVCNTR3_2_APPS_ADDR A:0x1e29e0c
y.create.l HWIO_APPS_SMMU_CB10_PMEVCNTR3_2_APPS_ADDR A:0x1e2ae0c
y.create.l HWIO_APPS_SMMU_CB11_PMEVCNTR3_2_APPS_ADDR A:0x1e2be0c
y.create.l HWIO_APPS_SMMU_CB12_PMEVCNTR3_2_APPS_ADDR A:0x1e2ce0c
y.create.l HWIO_APPS_SMMU_CB13_PMEVCNTR3_2_APPS_ADDR A:0x1e2de0c
y.create.l HWIO_APPS_SMMU_CB14_PMEVCNTR3_2_APPS_ADDR A:0x1e2ee0c
y.create.l HWIO_APPS_SMMU_CB15_PMEVCNTR3_2_APPS_ADDR A:0x1e2fe0c
y.create.l HWIO_APPS_SMMU_CB16_PMEVCNTR3_2_APPS_ADDR A:0x1e30e0c
y.create.l HWIO_APPS_SMMU_CB17_PMEVCNTR3_2_APPS_ADDR A:0x1e31e0c
y.create.l HWIO_APPS_SMMU_CB18_PMEVCNTR3_2_APPS_ADDR A:0x1e32e0c
y.create.l HWIO_APPS_SMMU_CB19_PMEVCNTR3_2_APPS_ADDR A:0x1e33e0c
y.create.l HWIO_APPS_SMMU_CB20_PMEVCNTR3_2_APPS_ADDR A:0x1e34e0c
y.create.l HWIO_APPS_SMMU_CB21_PMEVCNTR3_2_APPS_ADDR A:0x1e35e0c
y.create.l HWIO_APPS_SMMU_CB22_PMEVCNTR3_2_APPS_ADDR A:0x1e36e0c
y.create.l HWIO_APPS_SMMU_CB23_PMEVCNTR3_2_APPS_ADDR A:0x1e37e0c
y.create.l HWIO_APPS_SMMU_CB24_PMEVCNTR3_2_APPS_ADDR A:0x1e38e0c
y.create.l HWIO_APPS_SMMU_CB25_PMEVCNTR3_2_APPS_ADDR A:0x1e39e0c
y.create.l HWIO_APPS_SMMU_CB26_PMEVCNTR3_2_APPS_ADDR A:0x1e3ae0c
y.create.l HWIO_APPS_SMMU_CB27_PMEVCNTR3_2_APPS_ADDR A:0x1e3be0c
y.create.l HWIO_APPS_SMMU_CB28_PMEVCNTR3_2_APPS_ADDR A:0x1e3ce0c
y.create.l HWIO_APPS_SMMU_CB29_PMEVCNTR3_2_APPS_ADDR A:0x1e3de0c
y.create.l HWIO_APPS_SMMU_CB30_PMEVCNTR3_2_APPS_ADDR A:0x1e3ee0c
y.create.l HWIO_APPS_SMMU_CB31_PMEVCNTR3_2_APPS_ADDR A:0x1e3fe0c
y.create.l HWIO_APPS_SMMU_CB0_PMEVTYPER0_2_APPS_ADDR A:0x1e20e80
y.create.l HWIO_APPS_SMMU_CB1_PMEVTYPER0_2_APPS_ADDR A:0x1e21e80
y.create.l HWIO_APPS_SMMU_CB2_PMEVTYPER0_2_APPS_ADDR A:0x1e22e80
y.create.l HWIO_APPS_SMMU_CB3_PMEVTYPER0_2_APPS_ADDR A:0x1e23e80
y.create.l HWIO_APPS_SMMU_CB4_PMEVTYPER0_2_APPS_ADDR A:0x1e24e80
y.create.l HWIO_APPS_SMMU_CB5_PMEVTYPER0_2_APPS_ADDR A:0x1e25e80
y.create.l HWIO_APPS_SMMU_CB6_PMEVTYPER0_2_APPS_ADDR A:0x1e26e80
y.create.l HWIO_APPS_SMMU_CB7_PMEVTYPER0_2_APPS_ADDR A:0x1e27e80
y.create.l HWIO_APPS_SMMU_CB8_PMEVTYPER0_2_APPS_ADDR A:0x1e28e80
y.create.l HWIO_APPS_SMMU_CB9_PMEVTYPER0_2_APPS_ADDR A:0x1e29e80
y.create.l HWIO_APPS_SMMU_CB10_PMEVTYPER0_2_APPS_ADDR A:0x1e2ae80
y.create.l HWIO_APPS_SMMU_CB11_PMEVTYPER0_2_APPS_ADDR A:0x1e2be80
y.create.l HWIO_APPS_SMMU_CB12_PMEVTYPER0_2_APPS_ADDR A:0x1e2ce80
y.create.l HWIO_APPS_SMMU_CB13_PMEVTYPER0_2_APPS_ADDR A:0x1e2de80
y.create.l HWIO_APPS_SMMU_CB14_PMEVTYPER0_2_APPS_ADDR A:0x1e2ee80
y.create.l HWIO_APPS_SMMU_CB15_PMEVTYPER0_2_APPS_ADDR A:0x1e2fe80
y.create.l HWIO_APPS_SMMU_CB16_PMEVTYPER0_2_APPS_ADDR A:0x1e30e80
y.create.l HWIO_APPS_SMMU_CB17_PMEVTYPER0_2_APPS_ADDR A:0x1e31e80
y.create.l HWIO_APPS_SMMU_CB18_PMEVTYPER0_2_APPS_ADDR A:0x1e32e80
y.create.l HWIO_APPS_SMMU_CB19_PMEVTYPER0_2_APPS_ADDR A:0x1e33e80
y.create.l HWIO_APPS_SMMU_CB20_PMEVTYPER0_2_APPS_ADDR A:0x1e34e80
y.create.l HWIO_APPS_SMMU_CB21_PMEVTYPER0_2_APPS_ADDR A:0x1e35e80
y.create.l HWIO_APPS_SMMU_CB22_PMEVTYPER0_2_APPS_ADDR A:0x1e36e80
y.create.l HWIO_APPS_SMMU_CB23_PMEVTYPER0_2_APPS_ADDR A:0x1e37e80
y.create.l HWIO_APPS_SMMU_CB24_PMEVTYPER0_2_APPS_ADDR A:0x1e38e80
y.create.l HWIO_APPS_SMMU_CB25_PMEVTYPER0_2_APPS_ADDR A:0x1e39e80
y.create.l HWIO_APPS_SMMU_CB26_PMEVTYPER0_2_APPS_ADDR A:0x1e3ae80
y.create.l HWIO_APPS_SMMU_CB27_PMEVTYPER0_2_APPS_ADDR A:0x1e3be80
y.create.l HWIO_APPS_SMMU_CB28_PMEVTYPER0_2_APPS_ADDR A:0x1e3ce80
y.create.l HWIO_APPS_SMMU_CB29_PMEVTYPER0_2_APPS_ADDR A:0x1e3de80
y.create.l HWIO_APPS_SMMU_CB30_PMEVTYPER0_2_APPS_ADDR A:0x1e3ee80
y.create.l HWIO_APPS_SMMU_CB31_PMEVTYPER0_2_APPS_ADDR A:0x1e3fe80
y.create.l HWIO_APPS_SMMU_CB0_PMEVTYPER1_2_APPS_ADDR A:0x1e20e84
y.create.l HWIO_APPS_SMMU_CB1_PMEVTYPER1_2_APPS_ADDR A:0x1e21e84
y.create.l HWIO_APPS_SMMU_CB2_PMEVTYPER1_2_APPS_ADDR A:0x1e22e84
y.create.l HWIO_APPS_SMMU_CB3_PMEVTYPER1_2_APPS_ADDR A:0x1e23e84
y.create.l HWIO_APPS_SMMU_CB4_PMEVTYPER1_2_APPS_ADDR A:0x1e24e84
y.create.l HWIO_APPS_SMMU_CB5_PMEVTYPER1_2_APPS_ADDR A:0x1e25e84
y.create.l HWIO_APPS_SMMU_CB6_PMEVTYPER1_2_APPS_ADDR A:0x1e26e84
y.create.l HWIO_APPS_SMMU_CB7_PMEVTYPER1_2_APPS_ADDR A:0x1e27e84
y.create.l HWIO_APPS_SMMU_CB8_PMEVTYPER1_2_APPS_ADDR A:0x1e28e84
y.create.l HWIO_APPS_SMMU_CB9_PMEVTYPER1_2_APPS_ADDR A:0x1e29e84
y.create.l HWIO_APPS_SMMU_CB10_PMEVTYPER1_2_APPS_ADDR A:0x1e2ae84
y.create.l HWIO_APPS_SMMU_CB11_PMEVTYPER1_2_APPS_ADDR A:0x1e2be84
y.create.l HWIO_APPS_SMMU_CB12_PMEVTYPER1_2_APPS_ADDR A:0x1e2ce84
y.create.l HWIO_APPS_SMMU_CB13_PMEVTYPER1_2_APPS_ADDR A:0x1e2de84
y.create.l HWIO_APPS_SMMU_CB14_PMEVTYPER1_2_APPS_ADDR A:0x1e2ee84
y.create.l HWIO_APPS_SMMU_CB15_PMEVTYPER1_2_APPS_ADDR A:0x1e2fe84
y.create.l HWIO_APPS_SMMU_CB16_PMEVTYPER1_2_APPS_ADDR A:0x1e30e84
y.create.l HWIO_APPS_SMMU_CB17_PMEVTYPER1_2_APPS_ADDR A:0x1e31e84
y.create.l HWIO_APPS_SMMU_CB18_PMEVTYPER1_2_APPS_ADDR A:0x1e32e84
y.create.l HWIO_APPS_SMMU_CB19_PMEVTYPER1_2_APPS_ADDR A:0x1e33e84
y.create.l HWIO_APPS_SMMU_CB20_PMEVTYPER1_2_APPS_ADDR A:0x1e34e84
y.create.l HWIO_APPS_SMMU_CB21_PMEVTYPER1_2_APPS_ADDR A:0x1e35e84
y.create.l HWIO_APPS_SMMU_CB22_PMEVTYPER1_2_APPS_ADDR A:0x1e36e84
y.create.l HWIO_APPS_SMMU_CB23_PMEVTYPER1_2_APPS_ADDR A:0x1e37e84
y.create.l HWIO_APPS_SMMU_CB24_PMEVTYPER1_2_APPS_ADDR A:0x1e38e84
y.create.l HWIO_APPS_SMMU_CB25_PMEVTYPER1_2_APPS_ADDR A:0x1e39e84
y.create.l HWIO_APPS_SMMU_CB26_PMEVTYPER1_2_APPS_ADDR A:0x1e3ae84
y.create.l HWIO_APPS_SMMU_CB27_PMEVTYPER1_2_APPS_ADDR A:0x1e3be84
y.create.l HWIO_APPS_SMMU_CB28_PMEVTYPER1_2_APPS_ADDR A:0x1e3ce84
y.create.l HWIO_APPS_SMMU_CB29_PMEVTYPER1_2_APPS_ADDR A:0x1e3de84
y.create.l HWIO_APPS_SMMU_CB30_PMEVTYPER1_2_APPS_ADDR A:0x1e3ee84
y.create.l HWIO_APPS_SMMU_CB31_PMEVTYPER1_2_APPS_ADDR A:0x1e3fe84
y.create.l HWIO_APPS_SMMU_CB0_PMEVTYPER2_2_APPS_ADDR A:0x1e20e88
y.create.l HWIO_APPS_SMMU_CB1_PMEVTYPER2_2_APPS_ADDR A:0x1e21e88
y.create.l HWIO_APPS_SMMU_CB2_PMEVTYPER2_2_APPS_ADDR A:0x1e22e88
y.create.l HWIO_APPS_SMMU_CB3_PMEVTYPER2_2_APPS_ADDR A:0x1e23e88
y.create.l HWIO_APPS_SMMU_CB4_PMEVTYPER2_2_APPS_ADDR A:0x1e24e88
y.create.l HWIO_APPS_SMMU_CB5_PMEVTYPER2_2_APPS_ADDR A:0x1e25e88
y.create.l HWIO_APPS_SMMU_CB6_PMEVTYPER2_2_APPS_ADDR A:0x1e26e88
y.create.l HWIO_APPS_SMMU_CB7_PMEVTYPER2_2_APPS_ADDR A:0x1e27e88
y.create.l HWIO_APPS_SMMU_CB8_PMEVTYPER2_2_APPS_ADDR A:0x1e28e88
y.create.l HWIO_APPS_SMMU_CB9_PMEVTYPER2_2_APPS_ADDR A:0x1e29e88
y.create.l HWIO_APPS_SMMU_CB10_PMEVTYPER2_2_APPS_ADDR A:0x1e2ae88
y.create.l HWIO_APPS_SMMU_CB11_PMEVTYPER2_2_APPS_ADDR A:0x1e2be88
y.create.l HWIO_APPS_SMMU_CB12_PMEVTYPER2_2_APPS_ADDR A:0x1e2ce88
y.create.l HWIO_APPS_SMMU_CB13_PMEVTYPER2_2_APPS_ADDR A:0x1e2de88
y.create.l HWIO_APPS_SMMU_CB14_PMEVTYPER2_2_APPS_ADDR A:0x1e2ee88
y.create.l HWIO_APPS_SMMU_CB15_PMEVTYPER2_2_APPS_ADDR A:0x1e2fe88
y.create.l HWIO_APPS_SMMU_CB16_PMEVTYPER2_2_APPS_ADDR A:0x1e30e88
y.create.l HWIO_APPS_SMMU_CB17_PMEVTYPER2_2_APPS_ADDR A:0x1e31e88
y.create.l HWIO_APPS_SMMU_CB18_PMEVTYPER2_2_APPS_ADDR A:0x1e32e88
y.create.l HWIO_APPS_SMMU_CB19_PMEVTYPER2_2_APPS_ADDR A:0x1e33e88
y.create.l HWIO_APPS_SMMU_CB20_PMEVTYPER2_2_APPS_ADDR A:0x1e34e88
y.create.l HWIO_APPS_SMMU_CB21_PMEVTYPER2_2_APPS_ADDR A:0x1e35e88
y.create.l HWIO_APPS_SMMU_CB22_PMEVTYPER2_2_APPS_ADDR A:0x1e36e88
y.create.l HWIO_APPS_SMMU_CB23_PMEVTYPER2_2_APPS_ADDR A:0x1e37e88
y.create.l HWIO_APPS_SMMU_CB24_PMEVTYPER2_2_APPS_ADDR A:0x1e38e88
y.create.l HWIO_APPS_SMMU_CB25_PMEVTYPER2_2_APPS_ADDR A:0x1e39e88
y.create.l HWIO_APPS_SMMU_CB26_PMEVTYPER2_2_APPS_ADDR A:0x1e3ae88
y.create.l HWIO_APPS_SMMU_CB27_PMEVTYPER2_2_APPS_ADDR A:0x1e3be88
y.create.l HWIO_APPS_SMMU_CB28_PMEVTYPER2_2_APPS_ADDR A:0x1e3ce88
y.create.l HWIO_APPS_SMMU_CB29_PMEVTYPER2_2_APPS_ADDR A:0x1e3de88
y.create.l HWIO_APPS_SMMU_CB30_PMEVTYPER2_2_APPS_ADDR A:0x1e3ee88
y.create.l HWIO_APPS_SMMU_CB31_PMEVTYPER2_2_APPS_ADDR A:0x1e3fe88
y.create.l HWIO_APPS_SMMU_CB0_PMEVTYPER3_2_APPS_ADDR A:0x1e20e8c
y.create.l HWIO_APPS_SMMU_CB1_PMEVTYPER3_2_APPS_ADDR A:0x1e21e8c
y.create.l HWIO_APPS_SMMU_CB2_PMEVTYPER3_2_APPS_ADDR A:0x1e22e8c
y.create.l HWIO_APPS_SMMU_CB3_PMEVTYPER3_2_APPS_ADDR A:0x1e23e8c
y.create.l HWIO_APPS_SMMU_CB4_PMEVTYPER3_2_APPS_ADDR A:0x1e24e8c
y.create.l HWIO_APPS_SMMU_CB5_PMEVTYPER3_2_APPS_ADDR A:0x1e25e8c
y.create.l HWIO_APPS_SMMU_CB6_PMEVTYPER3_2_APPS_ADDR A:0x1e26e8c
y.create.l HWIO_APPS_SMMU_CB7_PMEVTYPER3_2_APPS_ADDR A:0x1e27e8c
y.create.l HWIO_APPS_SMMU_CB8_PMEVTYPER3_2_APPS_ADDR A:0x1e28e8c
y.create.l HWIO_APPS_SMMU_CB9_PMEVTYPER3_2_APPS_ADDR A:0x1e29e8c
y.create.l HWIO_APPS_SMMU_CB10_PMEVTYPER3_2_APPS_ADDR A:0x1e2ae8c
y.create.l HWIO_APPS_SMMU_CB11_PMEVTYPER3_2_APPS_ADDR A:0x1e2be8c
y.create.l HWIO_APPS_SMMU_CB12_PMEVTYPER3_2_APPS_ADDR A:0x1e2ce8c
y.create.l HWIO_APPS_SMMU_CB13_PMEVTYPER3_2_APPS_ADDR A:0x1e2de8c
y.create.l HWIO_APPS_SMMU_CB14_PMEVTYPER3_2_APPS_ADDR A:0x1e2ee8c
y.create.l HWIO_APPS_SMMU_CB15_PMEVTYPER3_2_APPS_ADDR A:0x1e2fe8c
y.create.l HWIO_APPS_SMMU_CB16_PMEVTYPER3_2_APPS_ADDR A:0x1e30e8c
y.create.l HWIO_APPS_SMMU_CB17_PMEVTYPER3_2_APPS_ADDR A:0x1e31e8c
y.create.l HWIO_APPS_SMMU_CB18_PMEVTYPER3_2_APPS_ADDR A:0x1e32e8c
y.create.l HWIO_APPS_SMMU_CB19_PMEVTYPER3_2_APPS_ADDR A:0x1e33e8c
y.create.l HWIO_APPS_SMMU_CB20_PMEVTYPER3_2_APPS_ADDR A:0x1e34e8c
y.create.l HWIO_APPS_SMMU_CB21_PMEVTYPER3_2_APPS_ADDR A:0x1e35e8c
y.create.l HWIO_APPS_SMMU_CB22_PMEVTYPER3_2_APPS_ADDR A:0x1e36e8c
y.create.l HWIO_APPS_SMMU_CB23_PMEVTYPER3_2_APPS_ADDR A:0x1e37e8c
y.create.l HWIO_APPS_SMMU_CB24_PMEVTYPER3_2_APPS_ADDR A:0x1e38e8c
y.create.l HWIO_APPS_SMMU_CB25_PMEVTYPER3_2_APPS_ADDR A:0x1e39e8c
y.create.l HWIO_APPS_SMMU_CB26_PMEVTYPER3_2_APPS_ADDR A:0x1e3ae8c
y.create.l HWIO_APPS_SMMU_CB27_PMEVTYPER3_2_APPS_ADDR A:0x1e3be8c
y.create.l HWIO_APPS_SMMU_CB28_PMEVTYPER3_2_APPS_ADDR A:0x1e3ce8c
y.create.l HWIO_APPS_SMMU_CB29_PMEVTYPER3_2_APPS_ADDR A:0x1e3de8c
y.create.l HWIO_APPS_SMMU_CB30_PMEVTYPER3_2_APPS_ADDR A:0x1e3ee8c
y.create.l HWIO_APPS_SMMU_CB31_PMEVTYPER3_2_APPS_ADDR A:0x1e3fe8c
y.create.l HWIO_APPS_SMMU_CB0_PMCFGR_2_APPS_ADDR A:0x1e20f00
y.create.l HWIO_APPS_SMMU_CB1_PMCFGR_2_APPS_ADDR A:0x1e21f00
y.create.l HWIO_APPS_SMMU_CB2_PMCFGR_2_APPS_ADDR A:0x1e22f00
y.create.l HWIO_APPS_SMMU_CB3_PMCFGR_2_APPS_ADDR A:0x1e23f00
y.create.l HWIO_APPS_SMMU_CB4_PMCFGR_2_APPS_ADDR A:0x1e24f00
y.create.l HWIO_APPS_SMMU_CB5_PMCFGR_2_APPS_ADDR A:0x1e25f00
y.create.l HWIO_APPS_SMMU_CB6_PMCFGR_2_APPS_ADDR A:0x1e26f00
y.create.l HWIO_APPS_SMMU_CB7_PMCFGR_2_APPS_ADDR A:0x1e27f00
y.create.l HWIO_APPS_SMMU_CB8_PMCFGR_2_APPS_ADDR A:0x1e28f00
y.create.l HWIO_APPS_SMMU_CB9_PMCFGR_2_APPS_ADDR A:0x1e29f00
y.create.l HWIO_APPS_SMMU_CB10_PMCFGR_2_APPS_ADDR A:0x1e2af00
y.create.l HWIO_APPS_SMMU_CB11_PMCFGR_2_APPS_ADDR A:0x1e2bf00
y.create.l HWIO_APPS_SMMU_CB12_PMCFGR_2_APPS_ADDR A:0x1e2cf00
y.create.l HWIO_APPS_SMMU_CB13_PMCFGR_2_APPS_ADDR A:0x1e2df00
y.create.l HWIO_APPS_SMMU_CB14_PMCFGR_2_APPS_ADDR A:0x1e2ef00
y.create.l HWIO_APPS_SMMU_CB15_PMCFGR_2_APPS_ADDR A:0x1e2ff00
y.create.l HWIO_APPS_SMMU_CB16_PMCFGR_2_APPS_ADDR A:0x1e30f00
y.create.l HWIO_APPS_SMMU_CB17_PMCFGR_2_APPS_ADDR A:0x1e31f00
y.create.l HWIO_APPS_SMMU_CB18_PMCFGR_2_APPS_ADDR A:0x1e32f00
y.create.l HWIO_APPS_SMMU_CB19_PMCFGR_2_APPS_ADDR A:0x1e33f00
y.create.l HWIO_APPS_SMMU_CB20_PMCFGR_2_APPS_ADDR A:0x1e34f00
y.create.l HWIO_APPS_SMMU_CB21_PMCFGR_2_APPS_ADDR A:0x1e35f00
y.create.l HWIO_APPS_SMMU_CB22_PMCFGR_2_APPS_ADDR A:0x1e36f00
y.create.l HWIO_APPS_SMMU_CB23_PMCFGR_2_APPS_ADDR A:0x1e37f00
y.create.l HWIO_APPS_SMMU_CB24_PMCFGR_2_APPS_ADDR A:0x1e38f00
y.create.l HWIO_APPS_SMMU_CB25_PMCFGR_2_APPS_ADDR A:0x1e39f00
y.create.l HWIO_APPS_SMMU_CB26_PMCFGR_2_APPS_ADDR A:0x1e3af00
y.create.l HWIO_APPS_SMMU_CB27_PMCFGR_2_APPS_ADDR A:0x1e3bf00
y.create.l HWIO_APPS_SMMU_CB28_PMCFGR_2_APPS_ADDR A:0x1e3cf00
y.create.l HWIO_APPS_SMMU_CB29_PMCFGR_2_APPS_ADDR A:0x1e3df00
y.create.l HWIO_APPS_SMMU_CB30_PMCFGR_2_APPS_ADDR A:0x1e3ef00
y.create.l HWIO_APPS_SMMU_CB31_PMCFGR_2_APPS_ADDR A:0x1e3ff00
y.create.l HWIO_APPS_SMMU_CB0_PMCR_2_APPS_ADDR A:0x1e20f04
y.create.l HWIO_APPS_SMMU_CB1_PMCR_2_APPS_ADDR A:0x1e21f04
y.create.l HWIO_APPS_SMMU_CB2_PMCR_2_APPS_ADDR A:0x1e22f04
y.create.l HWIO_APPS_SMMU_CB3_PMCR_2_APPS_ADDR A:0x1e23f04
y.create.l HWIO_APPS_SMMU_CB4_PMCR_2_APPS_ADDR A:0x1e24f04
y.create.l HWIO_APPS_SMMU_CB5_PMCR_2_APPS_ADDR A:0x1e25f04
y.create.l HWIO_APPS_SMMU_CB6_PMCR_2_APPS_ADDR A:0x1e26f04
y.create.l HWIO_APPS_SMMU_CB7_PMCR_2_APPS_ADDR A:0x1e27f04
y.create.l HWIO_APPS_SMMU_CB8_PMCR_2_APPS_ADDR A:0x1e28f04
y.create.l HWIO_APPS_SMMU_CB9_PMCR_2_APPS_ADDR A:0x1e29f04
y.create.l HWIO_APPS_SMMU_CB10_PMCR_2_APPS_ADDR A:0x1e2af04
y.create.l HWIO_APPS_SMMU_CB11_PMCR_2_APPS_ADDR A:0x1e2bf04
y.create.l HWIO_APPS_SMMU_CB12_PMCR_2_APPS_ADDR A:0x1e2cf04
y.create.l HWIO_APPS_SMMU_CB13_PMCR_2_APPS_ADDR A:0x1e2df04
y.create.l HWIO_APPS_SMMU_CB14_PMCR_2_APPS_ADDR A:0x1e2ef04
y.create.l HWIO_APPS_SMMU_CB15_PMCR_2_APPS_ADDR A:0x1e2ff04
y.create.l HWIO_APPS_SMMU_CB16_PMCR_2_APPS_ADDR A:0x1e30f04
y.create.l HWIO_APPS_SMMU_CB17_PMCR_2_APPS_ADDR A:0x1e31f04
y.create.l HWIO_APPS_SMMU_CB18_PMCR_2_APPS_ADDR A:0x1e32f04
y.create.l HWIO_APPS_SMMU_CB19_PMCR_2_APPS_ADDR A:0x1e33f04
y.create.l HWIO_APPS_SMMU_CB20_PMCR_2_APPS_ADDR A:0x1e34f04
y.create.l HWIO_APPS_SMMU_CB21_PMCR_2_APPS_ADDR A:0x1e35f04
y.create.l HWIO_APPS_SMMU_CB22_PMCR_2_APPS_ADDR A:0x1e36f04
y.create.l HWIO_APPS_SMMU_CB23_PMCR_2_APPS_ADDR A:0x1e37f04
y.create.l HWIO_APPS_SMMU_CB24_PMCR_2_APPS_ADDR A:0x1e38f04
y.create.l HWIO_APPS_SMMU_CB25_PMCR_2_APPS_ADDR A:0x1e39f04
y.create.l HWIO_APPS_SMMU_CB26_PMCR_2_APPS_ADDR A:0x1e3af04
y.create.l HWIO_APPS_SMMU_CB27_PMCR_2_APPS_ADDR A:0x1e3bf04
y.create.l HWIO_APPS_SMMU_CB28_PMCR_2_APPS_ADDR A:0x1e3cf04
y.create.l HWIO_APPS_SMMU_CB29_PMCR_2_APPS_ADDR A:0x1e3df04
y.create.l HWIO_APPS_SMMU_CB30_PMCR_2_APPS_ADDR A:0x1e3ef04
y.create.l HWIO_APPS_SMMU_CB31_PMCR_2_APPS_ADDR A:0x1e3ff04
y.create.l HWIO_APPS_SMMU_CB0_PMCEID_2_APPS_ADDR A:0x1e20f20
y.create.l HWIO_APPS_SMMU_CB1_PMCEID_2_APPS_ADDR A:0x1e21f20
y.create.l HWIO_APPS_SMMU_CB2_PMCEID_2_APPS_ADDR A:0x1e22f20
y.create.l HWIO_APPS_SMMU_CB3_PMCEID_2_APPS_ADDR A:0x1e23f20
y.create.l HWIO_APPS_SMMU_CB4_PMCEID_2_APPS_ADDR A:0x1e24f20
y.create.l HWIO_APPS_SMMU_CB5_PMCEID_2_APPS_ADDR A:0x1e25f20
y.create.l HWIO_APPS_SMMU_CB6_PMCEID_2_APPS_ADDR A:0x1e26f20
y.create.l HWIO_APPS_SMMU_CB7_PMCEID_2_APPS_ADDR A:0x1e27f20
y.create.l HWIO_APPS_SMMU_CB8_PMCEID_2_APPS_ADDR A:0x1e28f20
y.create.l HWIO_APPS_SMMU_CB9_PMCEID_2_APPS_ADDR A:0x1e29f20
y.create.l HWIO_APPS_SMMU_CB10_PMCEID_2_APPS_ADDR A:0x1e2af20
y.create.l HWIO_APPS_SMMU_CB11_PMCEID_2_APPS_ADDR A:0x1e2bf20
y.create.l HWIO_APPS_SMMU_CB12_PMCEID_2_APPS_ADDR A:0x1e2cf20
y.create.l HWIO_APPS_SMMU_CB13_PMCEID_2_APPS_ADDR A:0x1e2df20
y.create.l HWIO_APPS_SMMU_CB14_PMCEID_2_APPS_ADDR A:0x1e2ef20
y.create.l HWIO_APPS_SMMU_CB15_PMCEID_2_APPS_ADDR A:0x1e2ff20
y.create.l HWIO_APPS_SMMU_CB16_PMCEID_2_APPS_ADDR A:0x1e30f20
y.create.l HWIO_APPS_SMMU_CB17_PMCEID_2_APPS_ADDR A:0x1e31f20
y.create.l HWIO_APPS_SMMU_CB18_PMCEID_2_APPS_ADDR A:0x1e32f20
y.create.l HWIO_APPS_SMMU_CB19_PMCEID_2_APPS_ADDR A:0x1e33f20
y.create.l HWIO_APPS_SMMU_CB20_PMCEID_2_APPS_ADDR A:0x1e34f20
y.create.l HWIO_APPS_SMMU_CB21_PMCEID_2_APPS_ADDR A:0x1e35f20
y.create.l HWIO_APPS_SMMU_CB22_PMCEID_2_APPS_ADDR A:0x1e36f20
y.create.l HWIO_APPS_SMMU_CB23_PMCEID_2_APPS_ADDR A:0x1e37f20
y.create.l HWIO_APPS_SMMU_CB24_PMCEID_2_APPS_ADDR A:0x1e38f20
y.create.l HWIO_APPS_SMMU_CB25_PMCEID_2_APPS_ADDR A:0x1e39f20
y.create.l HWIO_APPS_SMMU_CB26_PMCEID_2_APPS_ADDR A:0x1e3af20
y.create.l HWIO_APPS_SMMU_CB27_PMCEID_2_APPS_ADDR A:0x1e3bf20
y.create.l HWIO_APPS_SMMU_CB28_PMCEID_2_APPS_ADDR A:0x1e3cf20
y.create.l HWIO_APPS_SMMU_CB29_PMCEID_2_APPS_ADDR A:0x1e3df20
y.create.l HWIO_APPS_SMMU_CB30_PMCEID_2_APPS_ADDR A:0x1e3ef20
y.create.l HWIO_APPS_SMMU_CB31_PMCEID_2_APPS_ADDR A:0x1e3ff20
y.create.l HWIO_APPS_SMMU_CB0_PMCNTENSE_2_APPS_ADDR A:0x1e20f40
y.create.l HWIO_APPS_SMMU_CB1_PMCNTENSE_2_APPS_ADDR A:0x1e21f40
y.create.l HWIO_APPS_SMMU_CB2_PMCNTENSE_2_APPS_ADDR A:0x1e22f40
y.create.l HWIO_APPS_SMMU_CB3_PMCNTENSE_2_APPS_ADDR A:0x1e23f40
y.create.l HWIO_APPS_SMMU_CB4_PMCNTENSE_2_APPS_ADDR A:0x1e24f40
y.create.l HWIO_APPS_SMMU_CB5_PMCNTENSE_2_APPS_ADDR A:0x1e25f40
y.create.l HWIO_APPS_SMMU_CB6_PMCNTENSE_2_APPS_ADDR A:0x1e26f40
y.create.l HWIO_APPS_SMMU_CB7_PMCNTENSE_2_APPS_ADDR A:0x1e27f40
y.create.l HWIO_APPS_SMMU_CB8_PMCNTENSE_2_APPS_ADDR A:0x1e28f40
y.create.l HWIO_APPS_SMMU_CB9_PMCNTENSE_2_APPS_ADDR A:0x1e29f40
y.create.l HWIO_APPS_SMMU_CB10_PMCNTENSE_2_APPS_ADDR A:0x1e2af40
y.create.l HWIO_APPS_SMMU_CB11_PMCNTENSE_2_APPS_ADDR A:0x1e2bf40
y.create.l HWIO_APPS_SMMU_CB12_PMCNTENSE_2_APPS_ADDR A:0x1e2cf40
y.create.l HWIO_APPS_SMMU_CB13_PMCNTENSE_2_APPS_ADDR A:0x1e2df40
y.create.l HWIO_APPS_SMMU_CB14_PMCNTENSE_2_APPS_ADDR A:0x1e2ef40
y.create.l HWIO_APPS_SMMU_CB15_PMCNTENSE_2_APPS_ADDR A:0x1e2ff40
y.create.l HWIO_APPS_SMMU_CB16_PMCNTENSE_2_APPS_ADDR A:0x1e30f40
y.create.l HWIO_APPS_SMMU_CB17_PMCNTENSE_2_APPS_ADDR A:0x1e31f40
y.create.l HWIO_APPS_SMMU_CB18_PMCNTENSE_2_APPS_ADDR A:0x1e32f40
y.create.l HWIO_APPS_SMMU_CB19_PMCNTENSE_2_APPS_ADDR A:0x1e33f40
y.create.l HWIO_APPS_SMMU_CB20_PMCNTENSE_2_APPS_ADDR A:0x1e34f40
y.create.l HWIO_APPS_SMMU_CB21_PMCNTENSE_2_APPS_ADDR A:0x1e35f40
y.create.l HWIO_APPS_SMMU_CB22_PMCNTENSE_2_APPS_ADDR A:0x1e36f40
y.create.l HWIO_APPS_SMMU_CB23_PMCNTENSE_2_APPS_ADDR A:0x1e37f40
y.create.l HWIO_APPS_SMMU_CB24_PMCNTENSE_2_APPS_ADDR A:0x1e38f40
y.create.l HWIO_APPS_SMMU_CB25_PMCNTENSE_2_APPS_ADDR A:0x1e39f40
y.create.l HWIO_APPS_SMMU_CB26_PMCNTENSE_2_APPS_ADDR A:0x1e3af40
y.create.l HWIO_APPS_SMMU_CB27_PMCNTENSE_2_APPS_ADDR A:0x1e3bf40
y.create.l HWIO_APPS_SMMU_CB28_PMCNTENSE_2_APPS_ADDR A:0x1e3cf40
y.create.l HWIO_APPS_SMMU_CB29_PMCNTENSE_2_APPS_ADDR A:0x1e3df40
y.create.l HWIO_APPS_SMMU_CB30_PMCNTENSE_2_APPS_ADDR A:0x1e3ef40
y.create.l HWIO_APPS_SMMU_CB31_PMCNTENSE_2_APPS_ADDR A:0x1e3ff40
y.create.l HWIO_APPS_SMMU_CB0_PMCNTENCLR_2_APPS_ADDR A:0x1e20f44
y.create.l HWIO_APPS_SMMU_CB1_PMCNTENCLR_2_APPS_ADDR A:0x1e21f44
y.create.l HWIO_APPS_SMMU_CB2_PMCNTENCLR_2_APPS_ADDR A:0x1e22f44
y.create.l HWIO_APPS_SMMU_CB3_PMCNTENCLR_2_APPS_ADDR A:0x1e23f44
y.create.l HWIO_APPS_SMMU_CB4_PMCNTENCLR_2_APPS_ADDR A:0x1e24f44
y.create.l HWIO_APPS_SMMU_CB5_PMCNTENCLR_2_APPS_ADDR A:0x1e25f44
y.create.l HWIO_APPS_SMMU_CB6_PMCNTENCLR_2_APPS_ADDR A:0x1e26f44
y.create.l HWIO_APPS_SMMU_CB7_PMCNTENCLR_2_APPS_ADDR A:0x1e27f44
y.create.l HWIO_APPS_SMMU_CB8_PMCNTENCLR_2_APPS_ADDR A:0x1e28f44
y.create.l HWIO_APPS_SMMU_CB9_PMCNTENCLR_2_APPS_ADDR A:0x1e29f44
y.create.l HWIO_APPS_SMMU_CB10_PMCNTENCLR_2_APPS_ADDR A:0x1e2af44
y.create.l HWIO_APPS_SMMU_CB11_PMCNTENCLR_2_APPS_ADDR A:0x1e2bf44
y.create.l HWIO_APPS_SMMU_CB12_PMCNTENCLR_2_APPS_ADDR A:0x1e2cf44
y.create.l HWIO_APPS_SMMU_CB13_PMCNTENCLR_2_APPS_ADDR A:0x1e2df44
y.create.l HWIO_APPS_SMMU_CB14_PMCNTENCLR_2_APPS_ADDR A:0x1e2ef44
y.create.l HWIO_APPS_SMMU_CB15_PMCNTENCLR_2_APPS_ADDR A:0x1e2ff44
y.create.l HWIO_APPS_SMMU_CB16_PMCNTENCLR_2_APPS_ADDR A:0x1e30f44
y.create.l HWIO_APPS_SMMU_CB17_PMCNTENCLR_2_APPS_ADDR A:0x1e31f44
y.create.l HWIO_APPS_SMMU_CB18_PMCNTENCLR_2_APPS_ADDR A:0x1e32f44
y.create.l HWIO_APPS_SMMU_CB19_PMCNTENCLR_2_APPS_ADDR A:0x1e33f44
y.create.l HWIO_APPS_SMMU_CB20_PMCNTENCLR_2_APPS_ADDR A:0x1e34f44
y.create.l HWIO_APPS_SMMU_CB21_PMCNTENCLR_2_APPS_ADDR A:0x1e35f44
y.create.l HWIO_APPS_SMMU_CB22_PMCNTENCLR_2_APPS_ADDR A:0x1e36f44
y.create.l HWIO_APPS_SMMU_CB23_PMCNTENCLR_2_APPS_ADDR A:0x1e37f44
y.create.l HWIO_APPS_SMMU_CB24_PMCNTENCLR_2_APPS_ADDR A:0x1e38f44
y.create.l HWIO_APPS_SMMU_CB25_PMCNTENCLR_2_APPS_ADDR A:0x1e39f44
y.create.l HWIO_APPS_SMMU_CB26_PMCNTENCLR_2_APPS_ADDR A:0x1e3af44
y.create.l HWIO_APPS_SMMU_CB27_PMCNTENCLR_2_APPS_ADDR A:0x1e3bf44
y.create.l HWIO_APPS_SMMU_CB28_PMCNTENCLR_2_APPS_ADDR A:0x1e3cf44
y.create.l HWIO_APPS_SMMU_CB29_PMCNTENCLR_2_APPS_ADDR A:0x1e3df44
y.create.l HWIO_APPS_SMMU_CB30_PMCNTENCLR_2_APPS_ADDR A:0x1e3ef44
y.create.l HWIO_APPS_SMMU_CB31_PMCNTENCLR_2_APPS_ADDR A:0x1e3ff44
y.create.l HWIO_APPS_SMMU_CB0_PMCNTENSET_2_APPS_ADDR A:0x1e20f48
y.create.l HWIO_APPS_SMMU_CB1_PMCNTENSET_2_APPS_ADDR A:0x1e21f48
y.create.l HWIO_APPS_SMMU_CB2_PMCNTENSET_2_APPS_ADDR A:0x1e22f48
y.create.l HWIO_APPS_SMMU_CB3_PMCNTENSET_2_APPS_ADDR A:0x1e23f48
y.create.l HWIO_APPS_SMMU_CB4_PMCNTENSET_2_APPS_ADDR A:0x1e24f48
y.create.l HWIO_APPS_SMMU_CB5_PMCNTENSET_2_APPS_ADDR A:0x1e25f48
y.create.l HWIO_APPS_SMMU_CB6_PMCNTENSET_2_APPS_ADDR A:0x1e26f48
y.create.l HWIO_APPS_SMMU_CB7_PMCNTENSET_2_APPS_ADDR A:0x1e27f48
y.create.l HWIO_APPS_SMMU_CB8_PMCNTENSET_2_APPS_ADDR A:0x1e28f48
y.create.l HWIO_APPS_SMMU_CB9_PMCNTENSET_2_APPS_ADDR A:0x1e29f48
y.create.l HWIO_APPS_SMMU_CB10_PMCNTENSET_2_APPS_ADDR A:0x1e2af48
y.create.l HWIO_APPS_SMMU_CB11_PMCNTENSET_2_APPS_ADDR A:0x1e2bf48
y.create.l HWIO_APPS_SMMU_CB12_PMCNTENSET_2_APPS_ADDR A:0x1e2cf48
y.create.l HWIO_APPS_SMMU_CB13_PMCNTENSET_2_APPS_ADDR A:0x1e2df48
y.create.l HWIO_APPS_SMMU_CB14_PMCNTENSET_2_APPS_ADDR A:0x1e2ef48
y.create.l HWIO_APPS_SMMU_CB15_PMCNTENSET_2_APPS_ADDR A:0x1e2ff48
y.create.l HWIO_APPS_SMMU_CB16_PMCNTENSET_2_APPS_ADDR A:0x1e30f48
y.create.l HWIO_APPS_SMMU_CB17_PMCNTENSET_2_APPS_ADDR A:0x1e31f48
y.create.l HWIO_APPS_SMMU_CB18_PMCNTENSET_2_APPS_ADDR A:0x1e32f48
y.create.l HWIO_APPS_SMMU_CB19_PMCNTENSET_2_APPS_ADDR A:0x1e33f48
y.create.l HWIO_APPS_SMMU_CB20_PMCNTENSET_2_APPS_ADDR A:0x1e34f48
y.create.l HWIO_APPS_SMMU_CB21_PMCNTENSET_2_APPS_ADDR A:0x1e35f48
y.create.l HWIO_APPS_SMMU_CB22_PMCNTENSET_2_APPS_ADDR A:0x1e36f48
y.create.l HWIO_APPS_SMMU_CB23_PMCNTENSET_2_APPS_ADDR A:0x1e37f48
y.create.l HWIO_APPS_SMMU_CB24_PMCNTENSET_2_APPS_ADDR A:0x1e38f48
y.create.l HWIO_APPS_SMMU_CB25_PMCNTENSET_2_APPS_ADDR A:0x1e39f48
y.create.l HWIO_APPS_SMMU_CB26_PMCNTENSET_2_APPS_ADDR A:0x1e3af48
y.create.l HWIO_APPS_SMMU_CB27_PMCNTENSET_2_APPS_ADDR A:0x1e3bf48
y.create.l HWIO_APPS_SMMU_CB28_PMCNTENSET_2_APPS_ADDR A:0x1e3cf48
y.create.l HWIO_APPS_SMMU_CB29_PMCNTENSET_2_APPS_ADDR A:0x1e3df48
y.create.l HWIO_APPS_SMMU_CB30_PMCNTENSET_2_APPS_ADDR A:0x1e3ef48
y.create.l HWIO_APPS_SMMU_CB31_PMCNTENSET_2_APPS_ADDR A:0x1e3ff48
y.create.l HWIO_APPS_SMMU_CB0_PMINTENCLR_2_APPS_ADDR A:0x1e20f4c
y.create.l HWIO_APPS_SMMU_CB1_PMINTENCLR_2_APPS_ADDR A:0x1e21f4c
y.create.l HWIO_APPS_SMMU_CB2_PMINTENCLR_2_APPS_ADDR A:0x1e22f4c
y.create.l HWIO_APPS_SMMU_CB3_PMINTENCLR_2_APPS_ADDR A:0x1e23f4c
y.create.l HWIO_APPS_SMMU_CB4_PMINTENCLR_2_APPS_ADDR A:0x1e24f4c
y.create.l HWIO_APPS_SMMU_CB5_PMINTENCLR_2_APPS_ADDR A:0x1e25f4c
y.create.l HWIO_APPS_SMMU_CB6_PMINTENCLR_2_APPS_ADDR A:0x1e26f4c
y.create.l HWIO_APPS_SMMU_CB7_PMINTENCLR_2_APPS_ADDR A:0x1e27f4c
y.create.l HWIO_APPS_SMMU_CB8_PMINTENCLR_2_APPS_ADDR A:0x1e28f4c
y.create.l HWIO_APPS_SMMU_CB9_PMINTENCLR_2_APPS_ADDR A:0x1e29f4c
y.create.l HWIO_APPS_SMMU_CB10_PMINTENCLR_2_APPS_ADDR A:0x1e2af4c
y.create.l HWIO_APPS_SMMU_CB11_PMINTENCLR_2_APPS_ADDR A:0x1e2bf4c
y.create.l HWIO_APPS_SMMU_CB12_PMINTENCLR_2_APPS_ADDR A:0x1e2cf4c
y.create.l HWIO_APPS_SMMU_CB13_PMINTENCLR_2_APPS_ADDR A:0x1e2df4c
y.create.l HWIO_APPS_SMMU_CB14_PMINTENCLR_2_APPS_ADDR A:0x1e2ef4c
y.create.l HWIO_APPS_SMMU_CB15_PMINTENCLR_2_APPS_ADDR A:0x1e2ff4c
y.create.l HWIO_APPS_SMMU_CB16_PMINTENCLR_2_APPS_ADDR A:0x1e30f4c
y.create.l HWIO_APPS_SMMU_CB17_PMINTENCLR_2_APPS_ADDR A:0x1e31f4c
y.create.l HWIO_APPS_SMMU_CB18_PMINTENCLR_2_APPS_ADDR A:0x1e32f4c
y.create.l HWIO_APPS_SMMU_CB19_PMINTENCLR_2_APPS_ADDR A:0x1e33f4c
y.create.l HWIO_APPS_SMMU_CB20_PMINTENCLR_2_APPS_ADDR A:0x1e34f4c
y.create.l HWIO_APPS_SMMU_CB21_PMINTENCLR_2_APPS_ADDR A:0x1e35f4c
y.create.l HWIO_APPS_SMMU_CB22_PMINTENCLR_2_APPS_ADDR A:0x1e36f4c
y.create.l HWIO_APPS_SMMU_CB23_PMINTENCLR_2_APPS_ADDR A:0x1e37f4c
y.create.l HWIO_APPS_SMMU_CB24_PMINTENCLR_2_APPS_ADDR A:0x1e38f4c
y.create.l HWIO_APPS_SMMU_CB25_PMINTENCLR_2_APPS_ADDR A:0x1e39f4c
y.create.l HWIO_APPS_SMMU_CB26_PMINTENCLR_2_APPS_ADDR A:0x1e3af4c
y.create.l HWIO_APPS_SMMU_CB27_PMINTENCLR_2_APPS_ADDR A:0x1e3bf4c
y.create.l HWIO_APPS_SMMU_CB28_PMINTENCLR_2_APPS_ADDR A:0x1e3cf4c
y.create.l HWIO_APPS_SMMU_CB29_PMINTENCLR_2_APPS_ADDR A:0x1e3df4c
y.create.l HWIO_APPS_SMMU_CB30_PMINTENCLR_2_APPS_ADDR A:0x1e3ef4c
y.create.l HWIO_APPS_SMMU_CB31_PMINTENCLR_2_APPS_ADDR A:0x1e3ff4c
y.create.l HWIO_APPS_SMMU_CB0_PMOVSCLR_2_APPS_ADDR A:0x1e20f50
y.create.l HWIO_APPS_SMMU_CB1_PMOVSCLR_2_APPS_ADDR A:0x1e21f50
y.create.l HWIO_APPS_SMMU_CB2_PMOVSCLR_2_APPS_ADDR A:0x1e22f50
y.create.l HWIO_APPS_SMMU_CB3_PMOVSCLR_2_APPS_ADDR A:0x1e23f50
y.create.l HWIO_APPS_SMMU_CB4_PMOVSCLR_2_APPS_ADDR A:0x1e24f50
y.create.l HWIO_APPS_SMMU_CB5_PMOVSCLR_2_APPS_ADDR A:0x1e25f50
y.create.l HWIO_APPS_SMMU_CB6_PMOVSCLR_2_APPS_ADDR A:0x1e26f50
y.create.l HWIO_APPS_SMMU_CB7_PMOVSCLR_2_APPS_ADDR A:0x1e27f50
y.create.l HWIO_APPS_SMMU_CB8_PMOVSCLR_2_APPS_ADDR A:0x1e28f50
y.create.l HWIO_APPS_SMMU_CB9_PMOVSCLR_2_APPS_ADDR A:0x1e29f50
y.create.l HWIO_APPS_SMMU_CB10_PMOVSCLR_2_APPS_ADDR A:0x1e2af50
y.create.l HWIO_APPS_SMMU_CB11_PMOVSCLR_2_APPS_ADDR A:0x1e2bf50
y.create.l HWIO_APPS_SMMU_CB12_PMOVSCLR_2_APPS_ADDR A:0x1e2cf50
y.create.l HWIO_APPS_SMMU_CB13_PMOVSCLR_2_APPS_ADDR A:0x1e2df50
y.create.l HWIO_APPS_SMMU_CB14_PMOVSCLR_2_APPS_ADDR A:0x1e2ef50
y.create.l HWIO_APPS_SMMU_CB15_PMOVSCLR_2_APPS_ADDR A:0x1e2ff50
y.create.l HWIO_APPS_SMMU_CB16_PMOVSCLR_2_APPS_ADDR A:0x1e30f50
y.create.l HWIO_APPS_SMMU_CB17_PMOVSCLR_2_APPS_ADDR A:0x1e31f50
y.create.l HWIO_APPS_SMMU_CB18_PMOVSCLR_2_APPS_ADDR A:0x1e32f50
y.create.l HWIO_APPS_SMMU_CB19_PMOVSCLR_2_APPS_ADDR A:0x1e33f50
y.create.l HWIO_APPS_SMMU_CB20_PMOVSCLR_2_APPS_ADDR A:0x1e34f50
y.create.l HWIO_APPS_SMMU_CB21_PMOVSCLR_2_APPS_ADDR A:0x1e35f50
y.create.l HWIO_APPS_SMMU_CB22_PMOVSCLR_2_APPS_ADDR A:0x1e36f50
y.create.l HWIO_APPS_SMMU_CB23_PMOVSCLR_2_APPS_ADDR A:0x1e37f50
y.create.l HWIO_APPS_SMMU_CB24_PMOVSCLR_2_APPS_ADDR A:0x1e38f50
y.create.l HWIO_APPS_SMMU_CB25_PMOVSCLR_2_APPS_ADDR A:0x1e39f50
y.create.l HWIO_APPS_SMMU_CB26_PMOVSCLR_2_APPS_ADDR A:0x1e3af50
y.create.l HWIO_APPS_SMMU_CB27_PMOVSCLR_2_APPS_ADDR A:0x1e3bf50
y.create.l HWIO_APPS_SMMU_CB28_PMOVSCLR_2_APPS_ADDR A:0x1e3cf50
y.create.l HWIO_APPS_SMMU_CB29_PMOVSCLR_2_APPS_ADDR A:0x1e3df50
y.create.l HWIO_APPS_SMMU_CB30_PMOVSCLR_2_APPS_ADDR A:0x1e3ef50
y.create.l HWIO_APPS_SMMU_CB31_PMOVSCLR_2_APPS_ADDR A:0x1e3ff50
y.create.l HWIO_APPS_SMMU_CB0_PMOVSSET_2_APPS_ADDR A:0x1e20f58
y.create.l HWIO_APPS_SMMU_CB1_PMOVSSET_2_APPS_ADDR A:0x1e21f58
y.create.l HWIO_APPS_SMMU_CB2_PMOVSSET_2_APPS_ADDR A:0x1e22f58
y.create.l HWIO_APPS_SMMU_CB3_PMOVSSET_2_APPS_ADDR A:0x1e23f58
y.create.l HWIO_APPS_SMMU_CB4_PMOVSSET_2_APPS_ADDR A:0x1e24f58
y.create.l HWIO_APPS_SMMU_CB5_PMOVSSET_2_APPS_ADDR A:0x1e25f58
y.create.l HWIO_APPS_SMMU_CB6_PMOVSSET_2_APPS_ADDR A:0x1e26f58
y.create.l HWIO_APPS_SMMU_CB7_PMOVSSET_2_APPS_ADDR A:0x1e27f58
y.create.l HWIO_APPS_SMMU_CB8_PMOVSSET_2_APPS_ADDR A:0x1e28f58
y.create.l HWIO_APPS_SMMU_CB9_PMOVSSET_2_APPS_ADDR A:0x1e29f58
y.create.l HWIO_APPS_SMMU_CB10_PMOVSSET_2_APPS_ADDR A:0x1e2af58
y.create.l HWIO_APPS_SMMU_CB11_PMOVSSET_2_APPS_ADDR A:0x1e2bf58
y.create.l HWIO_APPS_SMMU_CB12_PMOVSSET_2_APPS_ADDR A:0x1e2cf58
y.create.l HWIO_APPS_SMMU_CB13_PMOVSSET_2_APPS_ADDR A:0x1e2df58
y.create.l HWIO_APPS_SMMU_CB14_PMOVSSET_2_APPS_ADDR A:0x1e2ef58
y.create.l HWIO_APPS_SMMU_CB15_PMOVSSET_2_APPS_ADDR A:0x1e2ff58
y.create.l HWIO_APPS_SMMU_CB16_PMOVSSET_2_APPS_ADDR A:0x1e30f58
y.create.l HWIO_APPS_SMMU_CB17_PMOVSSET_2_APPS_ADDR A:0x1e31f58
y.create.l HWIO_APPS_SMMU_CB18_PMOVSSET_2_APPS_ADDR A:0x1e32f58
y.create.l HWIO_APPS_SMMU_CB19_PMOVSSET_2_APPS_ADDR A:0x1e33f58
y.create.l HWIO_APPS_SMMU_CB20_PMOVSSET_2_APPS_ADDR A:0x1e34f58
y.create.l HWIO_APPS_SMMU_CB21_PMOVSSET_2_APPS_ADDR A:0x1e35f58
y.create.l HWIO_APPS_SMMU_CB22_PMOVSSET_2_APPS_ADDR A:0x1e36f58
y.create.l HWIO_APPS_SMMU_CB23_PMOVSSET_2_APPS_ADDR A:0x1e37f58
y.create.l HWIO_APPS_SMMU_CB24_PMOVSSET_2_APPS_ADDR A:0x1e38f58
y.create.l HWIO_APPS_SMMU_CB25_PMOVSSET_2_APPS_ADDR A:0x1e39f58
y.create.l HWIO_APPS_SMMU_CB26_PMOVSSET_2_APPS_ADDR A:0x1e3af58
y.create.l HWIO_APPS_SMMU_CB27_PMOVSSET_2_APPS_ADDR A:0x1e3bf58
y.create.l HWIO_APPS_SMMU_CB28_PMOVSSET_2_APPS_ADDR A:0x1e3cf58
y.create.l HWIO_APPS_SMMU_CB29_PMOVSSET_2_APPS_ADDR A:0x1e3df58
y.create.l HWIO_APPS_SMMU_CB30_PMOVSSET_2_APPS_ADDR A:0x1e3ef58
y.create.l HWIO_APPS_SMMU_CB31_PMOVSSET_2_APPS_ADDR A:0x1e3ff58
y.create.l HWIO_APPS_SMMU_CB0_PMAUTHSTATUS_2_APPS_ADDR A:0x1e20fb8
y.create.l HWIO_APPS_SMMU_CB1_PMAUTHSTATUS_2_APPS_ADDR A:0x1e21fb8
y.create.l HWIO_APPS_SMMU_CB2_PMAUTHSTATUS_2_APPS_ADDR A:0x1e22fb8
y.create.l HWIO_APPS_SMMU_CB3_PMAUTHSTATUS_2_APPS_ADDR A:0x1e23fb8
y.create.l HWIO_APPS_SMMU_CB4_PMAUTHSTATUS_2_APPS_ADDR A:0x1e24fb8
y.create.l HWIO_APPS_SMMU_CB5_PMAUTHSTATUS_2_APPS_ADDR A:0x1e25fb8
y.create.l HWIO_APPS_SMMU_CB6_PMAUTHSTATUS_2_APPS_ADDR A:0x1e26fb8
y.create.l HWIO_APPS_SMMU_CB7_PMAUTHSTATUS_2_APPS_ADDR A:0x1e27fb8
y.create.l HWIO_APPS_SMMU_CB8_PMAUTHSTATUS_2_APPS_ADDR A:0x1e28fb8
y.create.l HWIO_APPS_SMMU_CB9_PMAUTHSTATUS_2_APPS_ADDR A:0x1e29fb8
y.create.l HWIO_APPS_SMMU_CB10_PMAUTHSTATUS_2_APPS_ADDR A:0x1e2afb8
y.create.l HWIO_APPS_SMMU_CB11_PMAUTHSTATUS_2_APPS_ADDR A:0x1e2bfb8
y.create.l HWIO_APPS_SMMU_CB12_PMAUTHSTATUS_2_APPS_ADDR A:0x1e2cfb8
y.create.l HWIO_APPS_SMMU_CB13_PMAUTHSTATUS_2_APPS_ADDR A:0x1e2dfb8
y.create.l HWIO_APPS_SMMU_CB14_PMAUTHSTATUS_2_APPS_ADDR A:0x1e2efb8
y.create.l HWIO_APPS_SMMU_CB15_PMAUTHSTATUS_2_APPS_ADDR A:0x1e2ffb8
y.create.l HWIO_APPS_SMMU_CB16_PMAUTHSTATUS_2_APPS_ADDR A:0x1e30fb8
y.create.l HWIO_APPS_SMMU_CB17_PMAUTHSTATUS_2_APPS_ADDR A:0x1e31fb8
y.create.l HWIO_APPS_SMMU_CB18_PMAUTHSTATUS_2_APPS_ADDR A:0x1e32fb8
y.create.l HWIO_APPS_SMMU_CB19_PMAUTHSTATUS_2_APPS_ADDR A:0x1e33fb8
y.create.l HWIO_APPS_SMMU_CB20_PMAUTHSTATUS_2_APPS_ADDR A:0x1e34fb8
y.create.l HWIO_APPS_SMMU_CB21_PMAUTHSTATUS_2_APPS_ADDR A:0x1e35fb8
y.create.l HWIO_APPS_SMMU_CB22_PMAUTHSTATUS_2_APPS_ADDR A:0x1e36fb8
y.create.l HWIO_APPS_SMMU_CB23_PMAUTHSTATUS_2_APPS_ADDR A:0x1e37fb8
y.create.l HWIO_APPS_SMMU_CB24_PMAUTHSTATUS_2_APPS_ADDR A:0x1e38fb8
y.create.l HWIO_APPS_SMMU_CB25_PMAUTHSTATUS_2_APPS_ADDR A:0x1e39fb8
y.create.l HWIO_APPS_SMMU_CB26_PMAUTHSTATUS_2_APPS_ADDR A:0x1e3afb8
y.create.l HWIO_APPS_SMMU_CB27_PMAUTHSTATUS_2_APPS_ADDR A:0x1e3bfb8
y.create.l HWIO_APPS_SMMU_CB28_PMAUTHSTATUS_2_APPS_ADDR A:0x1e3cfb8
y.create.l HWIO_APPS_SMMU_CB29_PMAUTHSTATUS_2_APPS_ADDR A:0x1e3dfb8
y.create.l HWIO_APPS_SMMU_CB30_PMAUTHSTATUS_2_APPS_ADDR A:0x1e3efb8
y.create.l HWIO_APPS_SMMU_CB31_PMAUTHSTATUS_2_APPS_ADDR A:0x1e3ffb8
y.create.l HWIO_SMMU_INTR_SEL_SEC_ADDR A:0x1ef0000
y.create.l HWIO_SMMU_MISC_TIE_OFF_SEC_ADDR A:0x1ef0008
y.create.l HWIO_SMMU_CATS_64_BIT_CTL_SEC_ADDR A:0x1ef0010
y.create.l HWIO_SMMU_CATS_128_BIT_CTL_SEC_ADDR A:0x1ef0018
y.create.l HWIO_SMMU_APP_TCU_PTW_VMID_SEC_ADDR A:0x1ef0020
y.create.l HWIO_SMMU_GFX_TCU_PTW_VMID_SEC_ADDR A:0x1ef0028
y.create.l HWIO_SMMU_SPARE_REG_1_SEC_ADDR A:0x1ef0030
y.create.l HWIO_SMMU_INTR_SEL_NSHYP_ADDR A:0x1ef1000
y.create.l HWIO_SMMU_GFX_AHB_4K_APERTURE_NSHYP_ADDR A:0x1ef1008
y.create.l HWIO_SMMU_MSA_BYPASS_ERR_ADDR_NSHYP_ADDR A:0x1ef1010
y.create.l HWIO_SMMU_MSA_BYPASS_INTR_EN_NSHYP_ADDR A:0x1ef1018
y.create.l HWIO_SMMU_MSA_BYPASS_INTR_STTS_NSHYP_ADDR A:0x1ef1020
y.create.l HWIO_SMMU_MSA_BYPASS_INTR_CLR_NSHYP_ADDR A:0x1ef1028
y.create.l HWIO_SMMU_INTR_SEL_NS_ADDR A:0x1ef2000
y.create.l HWIO_SMMU_TESTBUS_SEL_NS_ADDR A:0x1ef2008
y.create.l HWIO_SMMU_HW_INFO_NS_ADDR A:0x1ef2010
y.create.l HWIO_SMMU_HW_VERSION_NS_ADDR A:0x1ef2018
y.create.l HWIO_SMMU_MODEM_TBU_VA_PA_MATCH_MSA_ADDR A:0x1ef3000
y.create.l HWIO_SMMU_SID2VMID_SMR_VFE_0_ADDR A:0x1ef4000
y.create.l HWIO_SMMU_SID2VMID_SMR_VFE_1_ADDR A:0x1ef4008
y.create.l HWIO_SMMU_SID2VMID_SMR_VFE_2_ADDR A:0x1ef4010
y.create.l HWIO_SMMU_SID2VMID_SMR_VFE_3_ADDR A:0x1ef4018
y.create.l HWIO_SMMU_SID2VMID_FAULT_VMID_VFE_ADDR A:0x1ef4020
y.create.l HWIO_SMMU_SID2VMID_FAULT_INTR_EN_VFE_ADDR A:0x1ef4028
y.create.l HWIO_SMMU_SID2VMID_FAULT_INTR_STTS_VFE_ADDR A:0x1ef4030
y.create.l HWIO_SMMU_SID2VMID_FAULT_INTR_CLR_VFE_ADDR A:0x1ef4038
y.create.l HWIO_SMMU_PWR_CTRL_VFE_REQ_ADDR A:0x1ef4040
y.create.l HWIO_SMMU_PWR_CTRL_VFE_ACK_ADDR A:0x1ef4048
y.create.l HWIO_SMMU_SID2VMID_SMR_MDP_0_ADDR A:0x1ef5000
y.create.l HWIO_SMMU_SID2VMID_SMR_MDP_1_ADDR A:0x1ef5008
y.create.l HWIO_SMMU_SID2VMID_FAULT_VMID_MDP_ADDR A:0x1ef5010
y.create.l HWIO_SMMU_SID2VMID_FAULT_INTR_EN_MDP_ADDR A:0x1ef5018
y.create.l HWIO_SMMU_SID2VMID_FAULT_INTR_STTS_MDP_ADDR A:0x1ef5020
y.create.l HWIO_SMMU_SID2VMID_FAULT_INTR_CLR_MDP_ADDR A:0x1ef5028
y.create.l HWIO_SMMU_PWR_CTRL_MDP_REQ_ADDR A:0x1ef5030
y.create.l HWIO_SMMU_PWR_CTRL_MDP_ACK_ADDR A:0x1ef5038
y.create.l HWIO_SMMU_SID2VMID_SMR_VENUS_0_ADDR A:0x1ef6000
y.create.l HWIO_SMMU_SID2VMID_SMR_VENUS_1_ADDR A:0x1ef6008
y.create.l HWIO_SMMU_SID2VMID_SMR_VENUS_2_ADDR A:0x1ef6010
y.create.l HWIO_SMMU_SID2VMID_SMR_VENUS_3_ADDR A:0x1ef6018
y.create.l HWIO_SMMU_SID2VMID_SMR_VENUS_4_ADDR A:0x1ef6020
y.create.l HWIO_SMMU_SID2VMID_SMR_VENUS_5_ADDR A:0x1ef6028
y.create.l HWIO_SMMU_SID2VMID_SMR_VENUS_6_ADDR A:0x1ef6030
y.create.l HWIO_SMMU_SID2VMID_SMR_VENUS_7_ADDR A:0x1ef6038
y.create.l HWIO_SMMU_SID2VMID_SMR_VENUS_8_ADDR A:0x1ef6040
y.create.l HWIO_SMMU_SID2VMID_SMR_VENUS_9_ADDR A:0x1ef6048
y.create.l HWIO_SMMU_SID2VMID_FAULT_VMID_VENUS_ADDR A:0x1ef6090
y.create.l HWIO_SMMU_SID2VMID_FAULT_INTR_EN_VENUS_ADDR A:0x1ef6098
y.create.l HWIO_SMMU_SID2VMID_FAULT_INTR_STTS_VENUS_ADDR A:0x1ef60a0
y.create.l HWIO_SMMU_SID2VMID_FAULT_INTR_CLR_VENUS_ADDR A:0x1ef60a8
y.create.l HWIO_SMMU_PWR_CTRL_VENUS_REQ_ADDR A:0x1ef60b0
y.create.l HWIO_SMMU_PWR_CTRL_VENUS_ACK_ADDR A:0x1ef60b8
y.create.l HWIO_SMMU_SID2VMID_SMR_PRONTO_0_ADDR A:0x1ef7000
y.create.l HWIO_SMMU_SID2VMID_SMR_PRONTO_1_ADDR A:0x1ef7008
y.create.l HWIO_SMMU_SID2VMID_SMR_PRONTO_2_ADDR A:0x1ef7010
y.create.l HWIO_SMMU_SID2VMID_SMR_PRONTO_3_ADDR A:0x1ef7018
y.create.l HWIO_SMMU_SID2VMID_SMR_PRONTO_4_ADDR A:0x1ef7020
y.create.l HWIO_SMMU_SID2VMID_SMR_PRONTO_5_ADDR A:0x1ef7028
y.create.l HWIO_SMMU_SID2VMID_SMR_PRONTO_6_ADDR A:0x1ef7030
y.create.l HWIO_SMMU_SID2VMID_SMR_PRONTO_7_ADDR A:0x1ef7038
y.create.l HWIO_SMMU_SID2VMID_SMR_PRONTO_8_ADDR A:0x1ef7040
y.create.l HWIO_SMMU_SID2VMID_SMR_PRONTO_9_ADDR A:0x1ef7048
y.create.l HWIO_SMMU_SID2VMID_FAULT_VMID_PRONTO_ADDR A:0x1ef7068
y.create.l HWIO_SMMU_SID2VMID_FAULT_INTR_EN_PRONTO_ADDR A:0x1ef7070
y.create.l HWIO_SMMU_SID2VMID_FAULT_INTR_STTS_PRONTO_ADDR A:0x1ef7078
y.create.l HWIO_SMMU_SID2VMID_FAULT_INTR_CLR_PRONTO_ADDR A:0x1ef7080
y.create.l HWIO_SMMU_PWR_CTRL_PRONTO_REQ_ADDR A:0x1ef7088
y.create.l HWIO_SMMU_PWR_CTRL_PRONTO_ACK_ADDR A:0x1ef7090
y.create.l HWIO_SMMU_SID2VMID_SMR_PERIPH_0_ADDR A:0x1ef8000
y.create.l HWIO_SMMU_SID2VMID_SMR_PERIPH_1_ADDR A:0x1ef8008
y.create.l HWIO_SMMU_SID2VMID_SMR_PERIPH_2_ADDR A:0x1ef8010
y.create.l HWIO_SMMU_SID2VMID_SMR_PERIPH_3_ADDR A:0x1ef8018
y.create.l HWIO_SMMU_SID2VMID_SMR_PERIPH_4_ADDR A:0x1ef8020
y.create.l HWIO_SMMU_SID2VMID_SMR_PERIPH_5_ADDR A:0x1ef8028
y.create.l HWIO_SMMU_SID2VMID_SMR_PERIPH_6_ADDR A:0x1ef8030
y.create.l HWIO_SMMU_SID2VMID_SMR_PERIPH_7_ADDR A:0x1ef8038
y.create.l HWIO_SMMU_SID2VMID_SMR_PERIPH_8_ADDR A:0x1ef8040
y.create.l HWIO_SMMU_SID2VMID_SMR_PERIPH_9_ADDR A:0x1ef8048
y.create.l HWIO_SMMU_SID2VMID_FAULT_VMID_PERIPH_ADDR A:0x1ef8178
y.create.l HWIO_SMMU_SID2VMID_FAULT_INTR_EN_PERIPH_ADDR A:0x1ef8180
y.create.l HWIO_SMMU_SID2VMID_FAULT_INTR_STTS_PERIPH_ADDR A:0x1ef8188
y.create.l HWIO_SMMU_SID2VMID_FAULT_INTR_CLR_PERIPH_ADDR A:0x1ef8190
y.create.l HWIO_SMMU_PWR_CTRL_PERIPH_REQ_ADDR A:0x1ef8198
y.create.l HWIO_SMMU_PWR_CTRL_PERIPH_ACK_ADDR A:0x1ef81a0
y.create.l HWIO_SMMU_SID2VMID_SMR_DIME_0_ADDR A:0x1ef9000
y.create.l HWIO_SMMU_SID2VMID_SMR_DIME_1_ADDR A:0x1ef9008
y.create.l HWIO_SMMU_SID2VMID_FAULT_VMID_DIME_ADDR A:0x1ef9010
y.create.l HWIO_SMMU_SID2VMID_FAULT_INTR_EN_DIME_ADDR A:0x1ef9018
y.create.l HWIO_SMMU_SID2VMID_FAULT_INTR_STTS_DIME_ADDR A:0x1ef9020
y.create.l HWIO_SMMU_SID2VMID_FAULT_INTR_CLR_DIME_ADDR A:0x1ef9028
y.create.l HWIO_SMMU_PWR_CTRL_DIME_REQ_ADDR A:0x1ef9030
y.create.l HWIO_SMMU_PWR_CTRL_DIME_ACK_ADDR A:0x1ef9038
y.create.l HWIO_SMMU_SID2VMID_SMR_GPS_0_ADDR A:0x1efa000
y.create.l HWIO_SMMU_SID2VMID_SMR_GPS_1_ADDR A:0x1efa008
y.create.l HWIO_SMMU_SID2VMID_FAULT_VMID_GPS_ADDR A:0x1efa010
y.create.l HWIO_SMMU_SID2VMID_FAULT_INTR_EN_GPS_ADDR A:0x1efa018
y.create.l HWIO_SMMU_SID2VMID_FAULT_INTR_STTS_GPS_ADDR A:0x1efa020
y.create.l HWIO_SMMU_SID2VMID_FAULT_INTR_CLR_GPS_ADDR A:0x1efa028
y.create.l HWIO_SMMU_PWR_CTRL_GPS_REQ_ADDR A:0x1efa030
y.create.l HWIO_SMMU_PWR_CTRL_GPS_ACK_ADDR A:0x1efa038
y.create.l HWIO_SMMU_SID2VMID_SMR_QDSP_0_ADDR A:0x1efb000
y.create.l HWIO_SMMU_SID2VMID_SMR_QDSP_1_ADDR A:0x1efb008
y.create.l HWIO_SMMU_SID2VMID_SMR_QDSP_2_ADDR A:0x1efb010
y.create.l HWIO_SMMU_SID2VMID_SMR_QDSP_3_ADDR A:0x1efb018
y.create.l HWIO_SMMU_SID2VMID_FAULT_VMID_QDSP_ADDR A:0x1efb020
y.create.l HWIO_SMMU_SID2VMID_FAULT_INTR_EN_QDSP_ADDR A:0x1efb028
y.create.l HWIO_SMMU_SID2VMID_FAULT_INTR_STTS_QDSP_ADDR A:0x1efb030
y.create.l HWIO_SMMU_SID2VMID_FAULT_INTR_CLR_QDSP_ADDR A:0x1efb038
y.create.l HWIO_SMMU_PWR_CTRL_QDSP_REQ_ADDR A:0x1efb040
y.create.l HWIO_SMMU_PWR_CTRL_QDSP_ACK_ADDR A:0x1efb048
y.create.l HWIO_SMMU_SID2VMID_SMR_GFX_0_ADDR A:0x1efc000
y.create.l HWIO_SMMU_SID2VMID_SMR_GFX_1_ADDR A:0x1efc008
y.create.l HWIO_SMMU_SID2VMID_FAULT_VMID_GFX_ADDR A:0x1efc010
y.create.l HWIO_SMMU_SID2VMID_FAULT_INTR_EN_GFX_ADDR A:0x1efc018
y.create.l HWIO_SMMU_SID2VMID_FAULT_INTR_STTS_GFX_ADDR A:0x1efc020
y.create.l HWIO_SMMU_SID2VMID_FAULT_INTR_CLR_GFX_ADDR A:0x1efc028
y.create.l HWIO_SMMU_PWR_CTRL_GFX_REQ_ADDR A:0x1efc030
y.create.l HWIO_SMMU_PWR_CTRL_GFX_ACK_ADDR A:0x1efc038
y.create.l HWIO_GFX_SMMU_SCR0_GFX_ADDR A:0x1f00000
y.create.l HWIO_GFX_SMMU_NSCR0_GFX_ADDR A:0x1f00400
y.create.l HWIO_GFX_SMMU_SCR1_GFX_ADDR A:0x1f00004
y.create.l HWIO_GFX_SMMU_SACR_GFX_ADDR A:0x1f00010
y.create.l HWIO_GFX_SMMU_NSACR_GFX_ADDR A:0x1f00410
y.create.l HWIO_GFX_SMMU_SIDR0_GFX_ADDR A:0x1f00020
y.create.l HWIO_GFX_SMMU_SIDR1_GFX_ADDR A:0x1f00024
y.create.l HWIO_GFX_SMMU_SIDR2_GFX_ADDR A:0x1f00028
y.create.l HWIO_GFX_SMMU_SIDR7_GFX_ADDR A:0x1f0003c
y.create.l HWIO_GFX_SMMU_SGFAR_LOW_GFX_ADDR A:0x1f00040
y.create.l HWIO_GFX_SMMU_SGFAR_HIGH_GFX_ADDR A:0x1f00044
y.create.l HWIO_GFX_SMMU_NSGFAR_LOW_GFX_ADDR A:0x1f00440
y.create.l HWIO_GFX_SMMU_NSGFAR_HIGH_GFX_ADDR A:0x1f00444
y.create.l HWIO_GFX_SMMU_SGFSR_GFX_ADDR A:0x1f00048
y.create.l HWIO_GFX_SMMU_NSGFSR_GFX_ADDR A:0x1f00448
y.create.l HWIO_GFX_SMMU_SGFSRRESTORE_GFX_ADDR A:0x1f0004c
y.create.l HWIO_GFX_SMMU_NSGFSRRESTORE_GFX_ADDR A:0x1f0044c
y.create.l HWIO_GFX_SMMU_SGFSYNR0_GFX_ADDR A:0x1f00050
y.create.l HWIO_GFX_SMMU_NSGFSYNR0_GFX_ADDR A:0x1f00450
y.create.l HWIO_GFX_SMMU_SGFSYNR1_GFX_ADDR A:0x1f00054
y.create.l HWIO_GFX_SMMU_NSGFSYNDR1_GFX_ADDR A:0x1f00454
y.create.l HWIO_GFX_SMMU_STLBIALL_GFX_ADDR A:0x1f00060
y.create.l HWIO_GFX_SMMU_TLBIVMID_GFX_ADDR A:0x1f00064
y.create.l HWIO_GFX_SMMU_TLBIALLNSNH_GFX_ADDR A:0x1f00068
y.create.l HWIO_GFX_SMMU_NSTLBGSYNC_GFX_ADDR A:0x1f00470
y.create.l HWIO_GFX_SMMU_STLBGSYNC_GFX_ADDR A:0x1f00070
y.create.l HWIO_GFX_SMMU_STLBGSTATUS_GFX_ADDR A:0x1f00074
y.create.l HWIO_GFX_SMMU_NSTLBGSTATUS_GFX_ADDR A:0x1f00474
y.create.l HWIO_GFX_SMMU_DBGRPTRTBU_GFX_ADDR A:0x1f00080
y.create.l HWIO_GFX_SMMU_DBGRDATATBU_GFX_ADDR A:0x1f00084
y.create.l HWIO_GFX_SMMU_DBGRPTRTCU_GFX_ADDR A:0x1f00088
y.create.l HWIO_GFX_SMMU_DBGRDATATCU_GFX_ADDR A:0x1f0008c
y.create.l HWIO_GFX_SMMU_STLBIVALM_LOW_GFX_ADDR A:0x1f000a0
y.create.l HWIO_GFX_SMMU_STLBIVALM_HIGH_GFX_ADDR A:0x1f000a4
y.create.l HWIO_GFX_SMMU_STLBIVAM_LOW_GFX_ADDR A:0x1f000a8
y.create.l HWIO_GFX_SMMU_STLBIVAM_HIGH_GFX_ADDR A:0x1f000ac
y.create.l HWIO_GFX_SMMU_STLBIALLM_GFX_ADDR A:0x1f000bc
y.create.l HWIO_GFX_SMMU_SMR0_GFX_ADDR A:0x1f00800
y.create.l HWIO_GFX_SMMU_SMR1_GFX_ADDR A:0x1f00804
y.create.l HWIO_GFX_SMMU_SMR2_GFX_ADDR A:0x1f00808
y.create.l HWIO_GFX_SMMU_SMR3_GFX_ADDR A:0x1f0080c
y.create.l HWIO_GFX_SMMU_S2CR0_GFX_ADDR A:0x1f00c00
y.create.l HWIO_GFX_SMMU_S2CR1_GFX_ADDR A:0x1f00c04
y.create.l HWIO_GFX_SMMU_S2CR2_GFX_ADDR A:0x1f00c08
y.create.l HWIO_GFX_SMMU_S2CR3_GFX_ADDR A:0x1f00c0c
y.create.l HWIO_GFX_SMMU_PIDR0_GFX_ADDR A:0x1f00fe0
y.create.l HWIO_GFX_SMMU_PIDR1_GFX_ADDR A:0x1f00fe4
y.create.l HWIO_GFX_SMMU_PIDR2_GFX_ADDR A:0x1f00fe8
y.create.l HWIO_GFX_SMMU_PIDR3_GFX_ADDR A:0x1f00fec
y.create.l HWIO_GFX_SMMU_PIDR4_GFX_ADDR A:0x1f00fd0
y.create.l HWIO_GFX_SMMU_PIDR5_GFX_ADDR A:0x1f00fd4
y.create.l HWIO_GFX_SMMU_PIDR6_GFX_ADDR A:0x1f00fd8
y.create.l HWIO_GFX_SMMU_PIDR7_GFX_ADDR A:0x1f00fdc
y.create.l HWIO_GFX_SMMU_CIDR0_GFX_ADDR A:0x1f00ff0
y.create.l HWIO_GFX_SMMU_CIDR1_GFX_ADDR A:0x1f00ff4
y.create.l HWIO_GFX_SMMU_CIDR2_GFX_ADDR A:0x1f00ff8
y.create.l HWIO_GFX_SMMU_CIDR3_GFX_ADDR A:0x1f00ffc
y.create.l HWIO_GFX_SMMU_CBAR0_GFX_ADDR A:0x1f01000
y.create.l HWIO_GFX_SMMU_CBFRSYNRA0_GFX_ADDR A:0x1f01400
y.create.l HWIO_GFX_SMMU_CBA2R0_GFX_ADDR A:0x1f01800
y.create.l HWIO_GFX_SMMU_CBAR1_GFX_ADDR A:0x1f01004
y.create.l HWIO_GFX_SMMU_CBFRSYNRA1_GFX_ADDR A:0x1f01404
y.create.l HWIO_GFX_SMMU_CBA2R1_GFX_ADDR A:0x1f01804
y.create.l HWIO_GFX_SMMU_CBAR2_GFX_ADDR A:0x1f01008
y.create.l HWIO_GFX_SMMU_CBFRSYNRA2_GFX_ADDR A:0x1f01408
y.create.l HWIO_GFX_SMMU_CBA2R2_GFX_ADDR A:0x1f01808
y.create.l HWIO_GFX_SMMU_CBAR3_GFX_ADDR A:0x1f0100c
y.create.l HWIO_GFX_SMMU_CBFRSYNRA3_GFX_ADDR A:0x1f0140c
y.create.l HWIO_GFX_SMMU_CBA2R3_GFX_ADDR A:0x1f0180c
y.create.l HWIO_GFX_SMMU_ITCTRL_GFX_ADDR A:0x1f02000
y.create.l HWIO_GFX_SMMU_ITIP_GFX_ADDR A:0x1f02004
y.create.l HWIO_GFX_SMMU_ITOP_GLBL_GFX_ADDR A:0x1f02008
y.create.l HWIO_GFX_SMMU_ITOP_PERF_INDEX_GFX_ADDR A:0x1f0200c
y.create.l HWIO_GFX_SMMU_ITOP_CXT0TO31_RAM0_GFX_ADDR A:0x1f02010
y.create.l HWIO_GFX_SMMU_TBUQOS0_GFX_ADDR A:0x1f02100
y.create.l HWIO_GFX_SMMU_PER_GFX_ADDR A:0x1f02200
y.create.l HWIO_GFX_SMMU_TBU_PWR_STATUS_GFX_ADDR A:0x1f02204
y.create.l HWIO_GFX_PMEVCNTR0_GFX_ADDR A:0x1f03000
y.create.l HWIO_GFX_PMEVCNTR1_GFX_ADDR A:0x1f03004
y.create.l HWIO_GFX_PMEVCNTR2_GFX_ADDR A:0x1f03008
y.create.l HWIO_GFX_PMEVCNTR3_GFX_ADDR A:0x1f0300c
y.create.l HWIO_GFX_PMEVTYPER0_GFX_ADDR A:0x1f03400
y.create.l HWIO_GFX_PMEVTYPER1_GFX_ADDR A:0x1f03404
y.create.l HWIO_GFX_PMEVTYPER2_GFX_ADDR A:0x1f03408
y.create.l HWIO_GFX_PMEVTYPER3_GFX_ADDR A:0x1f0340c
y.create.l HWIO_GFX_PMCGCR_GFX_ADDR A:0x1f03800
y.create.l HWIO_GFX_PMCGSMR_GFX_ADDR A:0x1f03a00
y.create.l HWIO_GFX_PMCNTENSET_GFX_ADDR A:0x1f03c00
y.create.l HWIO_GFX_PMCNTENCLR_GFX_ADDR A:0x1f03c20
y.create.l HWIO_GFX_PMINTENSET_GFX_ADDR A:0x1f03c40
y.create.l HWIO_GFX_PMINTENCLR_GFX_ADDR A:0x1f03c60
y.create.l HWIO_GFX_PMOVSCLR_GFX_ADDR A:0x1f03c80
y.create.l HWIO_GFX_PMOVSSET_GFX_ADDR A:0x1f03cc0
y.create.l HWIO_GFX_PMCFGR_GFX_ADDR A:0x1f03e00
y.create.l HWIO_GFX_PMCR_GFX_ADDR A:0x1f03e04
y.create.l HWIO_GFX_PMCEID0_GFX_ADDR A:0x1f03e20
y.create.l HWIO_GFX_PMAUTHSTATUS_GFX_ADDR A:0x1f03fb8
y.create.l HWIO_GFX_PMDEVTYPE_GFX_ADDR A:0x1f03fcc
y.create.l HWIO_GFX_SMMU_CB0_SCTLR_GFX_ADDR A:0x1f08000
y.create.l HWIO_GFX_SMMU_CB1_SCTLR_GFX_ADDR A:0x1f09000
y.create.l HWIO_GFX_SMMU_CB2_SCTLR_GFX_ADDR A:0x1f0a000
y.create.l HWIO_GFX_SMMU_CB3_SCTLR_GFX_ADDR A:0x1f0b000
y.create.l HWIO_GFX_SMMU_CB0_ACTLR_GFX_ADDR A:0x1f08004
y.create.l HWIO_GFX_SMMU_CB1_ACTLR_GFX_ADDR A:0x1f09004
y.create.l HWIO_GFX_SMMU_CB2_ACTLR_GFX_ADDR A:0x1f0a004
y.create.l HWIO_GFX_SMMU_CB3_ACTLR_GFX_ADDR A:0x1f0b004
y.create.l HWIO_GFX_SMMU_CB0_RESUME_GFX_ADDR A:0x1f08008
y.create.l HWIO_GFX_SMMU_CB1_RESUME_GFX_ADDR A:0x1f09008
y.create.l HWIO_GFX_SMMU_CB2_RESUME_GFX_ADDR A:0x1f0a008
y.create.l HWIO_GFX_SMMU_CB3_RESUME_GFX_ADDR A:0x1f0b008
y.create.l HWIO_GFX_SMMU_CB0_TCR2_GFX_ADDR A:0x1f08010
y.create.l HWIO_GFX_SMMU_CB1_TCR2_GFX_ADDR A:0x1f09010
y.create.l HWIO_GFX_SMMU_CB2_TCR2_GFX_ADDR A:0x1f0a010
y.create.l HWIO_GFX_SMMU_CB3_TCR2_GFX_ADDR A:0x1f0b010
y.create.l HWIO_GFX_SMMU_CB0_TTBR0_LOW_GFX_ADDR A:0x1f08020
y.create.l HWIO_GFX_SMMU_CB1_TTBR0_LOW_GFX_ADDR A:0x1f09020
y.create.l HWIO_GFX_SMMU_CB2_TTBR0_LOW_GFX_ADDR A:0x1f0a020
y.create.l HWIO_GFX_SMMU_CB3_TTBR0_LOW_GFX_ADDR A:0x1f0b020
y.create.l HWIO_GFX_SMMU_CB0_TTBR0_HIGH_GFX_ADDR A:0x1f08024
y.create.l HWIO_GFX_SMMU_CB1_TTBR0_HIGH_GFX_ADDR A:0x1f09024
y.create.l HWIO_GFX_SMMU_CB2_TTBR0_HIGH_GFX_ADDR A:0x1f0a024
y.create.l HWIO_GFX_SMMU_CB3_TTBR0_HIGH_GFX_ADDR A:0x1f0b024
y.create.l HWIO_GFX_SMMU_CB0_TTBR1_LOW_GFX_ADDR A:0x1f08028
y.create.l HWIO_GFX_SMMU_CB1_TTBR1_LOW_GFX_ADDR A:0x1f09028
y.create.l HWIO_GFX_SMMU_CB2_TTBR1_LOW_GFX_ADDR A:0x1f0a028
y.create.l HWIO_GFX_SMMU_CB3_TTBR1_LOW_GFX_ADDR A:0x1f0b028
y.create.l HWIO_GFX_SMMU_CB0_TTBR1_HIGH_GFX_ADDR A:0x1f0802c
y.create.l HWIO_GFX_SMMU_CB1_TTBR1_HIGH_GFX_ADDR A:0x1f0902c
y.create.l HWIO_GFX_SMMU_CB2_TTBR1_HIGH_GFX_ADDR A:0x1f0a02c
y.create.l HWIO_GFX_SMMU_CB3_TTBR1_HIGH_GFX_ADDR A:0x1f0b02c
y.create.l HWIO_GFX_SMMU_CB0_TCR_LPAE_GFX_ADDR A:0x1f08030
y.create.l HWIO_GFX_SMMU_CB1_TCR_LPAE_GFX_ADDR A:0x1f09030
y.create.l HWIO_GFX_SMMU_CB2_TCR_LPAE_GFX_ADDR A:0x1f0a030
y.create.l HWIO_GFX_SMMU_CB3_TCR_LPAE_GFX_ADDR A:0x1f0b030
y.create.l HWIO_GFX_SMMU_CB0_CONTEXTIDR_GFX_ADDR A:0x1f08034
y.create.l HWIO_GFX_SMMU_CB1_CONTEXTIDR_GFX_ADDR A:0x1f09034
y.create.l HWIO_GFX_SMMU_CB2_CONTEXTIDR_GFX_ADDR A:0x1f0a034
y.create.l HWIO_GFX_SMMU_CB3_CONTEXTIDR_GFX_ADDR A:0x1f0b034
y.create.l HWIO_GFX_SMMU_CB0_PRRR_MAIR0_GFX_ADDR A:0x1f08038
y.create.l HWIO_GFX_SMMU_CB1_PRRR_MAIR0_GFX_ADDR A:0x1f09038
y.create.l HWIO_GFX_SMMU_CB2_PRRR_MAIR0_GFX_ADDR A:0x1f0a038
y.create.l HWIO_GFX_SMMU_CB3_PRRR_MAIR0_GFX_ADDR A:0x1f0b038
y.create.l HWIO_GFX_SMMU_CB0_NMRR_MAIR1_GFX_ADDR A:0x1f0803c
y.create.l HWIO_GFX_SMMU_CB1_NMRR_MAIR1_GFX_ADDR A:0x1f0903c
y.create.l HWIO_GFX_SMMU_CB2_NMRR_MAIR1_GFX_ADDR A:0x1f0a03c
y.create.l HWIO_GFX_SMMU_CB3_NMRR_MAIR1_GFX_ADDR A:0x1f0b03c
y.create.l HWIO_GFX_SMMU_CB0_FSR_GFX_ADDR A:0x1f08058
y.create.l HWIO_GFX_SMMU_CB1_FSR_GFX_ADDR A:0x1f09058
y.create.l HWIO_GFX_SMMU_CB2_FSR_GFX_ADDR A:0x1f0a058
y.create.l HWIO_GFX_SMMU_CB3_FSR_GFX_ADDR A:0x1f0b058
y.create.l HWIO_GFX_SMMU_CB0_FSRRESTORE_GFX_ADDR A:0x1f0805c
y.create.l HWIO_GFX_SMMU_CB1_FSRRESTORE_GFX_ADDR A:0x1f0905c
y.create.l HWIO_GFX_SMMU_CB2_FSRRESTORE_GFX_ADDR A:0x1f0a05c
y.create.l HWIO_GFX_SMMU_CB3_FSRRESTORE_GFX_ADDR A:0x1f0b05c
y.create.l HWIO_GFX_SMMU_CB0_FAR_LOW_GFX_ADDR A:0x1f08060
y.create.l HWIO_GFX_SMMU_CB1_FAR_LOW_GFX_ADDR A:0x1f09060
y.create.l HWIO_GFX_SMMU_CB2_FAR_LOW_GFX_ADDR A:0x1f0a060
y.create.l HWIO_GFX_SMMU_CB3_FAR_LOW_GFX_ADDR A:0x1f0b060
y.create.l HWIO_GFX_SMMU_CB0_FAR_HIGH_GFX_ADDR A:0x1f08064
y.create.l HWIO_GFX_SMMU_CB1_FAR_HIGH_GFX_ADDR A:0x1f09064
y.create.l HWIO_GFX_SMMU_CB2_FAR_HIGH_GFX_ADDR A:0x1f0a064
y.create.l HWIO_GFX_SMMU_CB3_FAR_HIGH_GFX_ADDR A:0x1f0b064
y.create.l HWIO_GFX_SMMU_CB0_FSYNR0_GFX_ADDR A:0x1f08068
y.create.l HWIO_GFX_SMMU_CB1_FSYNR0_GFX_ADDR A:0x1f09068
y.create.l HWIO_GFX_SMMU_CB2_FSYNR0_GFX_ADDR A:0x1f0a068
y.create.l HWIO_GFX_SMMU_CB3_FSYNR0_GFX_ADDR A:0x1f0b068
y.create.l HWIO_GFX_SMMU_CB0_IPAFAR_LOW_GFX_ADDR A:0x1f08070
y.create.l HWIO_GFX_SMMU_CB1_IPAFAR_LOW_GFX_ADDR A:0x1f09070
y.create.l HWIO_GFX_SMMU_CB2_IPAFAR_LOW_GFX_ADDR A:0x1f0a070
y.create.l HWIO_GFX_SMMU_CB3_IPAFAR_LOW_GFX_ADDR A:0x1f0b070
y.create.l HWIO_GFX_SMMU_CB0_IPAFAR_HIGH_GFX_ADDR A:0x1f08074
y.create.l HWIO_GFX_SMMU_CB1_IPAFAR_HIGH_GFX_ADDR A:0x1f09074
y.create.l HWIO_GFX_SMMU_CB2_IPAFAR_HIGH_GFX_ADDR A:0x1f0a074
y.create.l HWIO_GFX_SMMU_CB3_IPAFAR_HIGH_GFX_ADDR A:0x1f0b074
y.create.l HWIO_GFX_SMMU_CB0_TLBIVA_LOW_GFX_ADDR A:0x1f08600
y.create.l HWIO_GFX_SMMU_CB1_TLBIVA_LOW_GFX_ADDR A:0x1f09600
y.create.l HWIO_GFX_SMMU_CB2_TLBIVA_LOW_GFX_ADDR A:0x1f0a600
y.create.l HWIO_GFX_SMMU_CB3_TLBIVA_LOW_GFX_ADDR A:0x1f0b600
y.create.l HWIO_GFX_SMMU_CB0_TLBIVA_HIGH_GFX_ADDR A:0x1f08604
y.create.l HWIO_GFX_SMMU_CB1_TLBIVA_HIGH_GFX_ADDR A:0x1f09604
y.create.l HWIO_GFX_SMMU_CB2_TLBIVA_HIGH_GFX_ADDR A:0x1f0a604
y.create.l HWIO_GFX_SMMU_CB3_TLBIVA_HIGH_GFX_ADDR A:0x1f0b604
y.create.l HWIO_GFX_SMMU_CB0_TLBIVAA_LOW_GFX_ADDR A:0x1f08608
y.create.l HWIO_GFX_SMMU_CB1_TLBIVAA_LOW_GFX_ADDR A:0x1f09608
y.create.l HWIO_GFX_SMMU_CB2_TLBIVAA_LOW_GFX_ADDR A:0x1f0a608
y.create.l HWIO_GFX_SMMU_CB3_TLBIVAA_LOW_GFX_ADDR A:0x1f0b608
y.create.l HWIO_GFX_SMMU_CB0_TLBIVAA_HIGH_GFX_ADDR A:0x1f0860c
y.create.l HWIO_GFX_SMMU_CB1_TLBIVAA_HIGH_GFX_ADDR A:0x1f0960c
y.create.l HWIO_GFX_SMMU_CB2_TLBIVAA_HIGH_GFX_ADDR A:0x1f0a60c
y.create.l HWIO_GFX_SMMU_CB3_TLBIVAA_HIGH_GFX_ADDR A:0x1f0b60c
y.create.l HWIO_GFX_SMMU_CB0_TLBIASID_GFX_ADDR A:0x1f08610
y.create.l HWIO_GFX_SMMU_CB1_TLBIASID_GFX_ADDR A:0x1f09610
y.create.l HWIO_GFX_SMMU_CB2_TLBIASID_GFX_ADDR A:0x1f0a610
y.create.l HWIO_GFX_SMMU_CB3_TLBIASID_GFX_ADDR A:0x1f0b610
y.create.l HWIO_GFX_SMMU_CB0_TLBIALL_GFX_ADDR A:0x1f08618
y.create.l HWIO_GFX_SMMU_CB1_TLBIALL_GFX_ADDR A:0x1f09618
y.create.l HWIO_GFX_SMMU_CB2_TLBIALL_GFX_ADDR A:0x1f0a618
y.create.l HWIO_GFX_SMMU_CB3_TLBIALL_GFX_ADDR A:0x1f0b618
y.create.l HWIO_GFX_SMMU_CB0_TLBIVAL_LOW_GFX_ADDR A:0x1f08620
y.create.l HWIO_GFX_SMMU_CB1_TLBIVAL_LOW_GFX_ADDR A:0x1f09620
y.create.l HWIO_GFX_SMMU_CB2_TLBIVAL_LOW_GFX_ADDR A:0x1f0a620
y.create.l HWIO_GFX_SMMU_CB3_TLBIVAL_LOW_GFX_ADDR A:0x1f0b620
y.create.l HWIO_GFX_SMMU_CB0_TLBIVAL_HIGH_GFX_ADDR A:0x1f08624
y.create.l HWIO_GFX_SMMU_CB1_TLBIVAL_HIGH_GFX_ADDR A:0x1f09624
y.create.l HWIO_GFX_SMMU_CB2_TLBIVAL_HIGH_GFX_ADDR A:0x1f0a624
y.create.l HWIO_GFX_SMMU_CB3_TLBIVAL_HIGH_GFX_ADDR A:0x1f0b624
y.create.l HWIO_GFX_SMMU_CB0_TLBIVAAL_LOW_GFX_ADDR A:0x1f08628
y.create.l HWIO_GFX_SMMU_CB1_TLBIVAAL_LOW_GFX_ADDR A:0x1f09628
y.create.l HWIO_GFX_SMMU_CB2_TLBIVAAL_LOW_GFX_ADDR A:0x1f0a628
y.create.l HWIO_GFX_SMMU_CB3_TLBIVAAL_LOW_GFX_ADDR A:0x1f0b628
y.create.l HWIO_GFX_SMMU_CB0_TLBIVAAL_HIGH_GFX_ADDR A:0x1f0862c
y.create.l HWIO_GFX_SMMU_CB1_TLBIVAAL_HIGH_GFX_ADDR A:0x1f0962c
y.create.l HWIO_GFX_SMMU_CB2_TLBIVAAL_HIGH_GFX_ADDR A:0x1f0a62c
y.create.l HWIO_GFX_SMMU_CB3_TLBIVAAL_HIGH_GFX_ADDR A:0x1f0b62c
y.create.l HWIO_GFX_SMMU_CB0_TLBIIPAS2_LOW_GFX_ADDR A:0x1f08630
y.create.l HWIO_GFX_SMMU_CB1_TLBIIPAS2_LOW_GFX_ADDR A:0x1f09630
y.create.l HWIO_GFX_SMMU_CB2_TLBIIPAS2_LOW_GFX_ADDR A:0x1f0a630
y.create.l HWIO_GFX_SMMU_CB3_TLBIIPAS2_LOW_GFX_ADDR A:0x1f0b630
y.create.l HWIO_GFX_SMMU_CB0_TLBIIPAS2_HIGH_GFX_ADDR A:0x1f08634
y.create.l HWIO_GFX_SMMU_CB1_TLBIIPAS2_HIGH_GFX_ADDR A:0x1f09634
y.create.l HWIO_GFX_SMMU_CB2_TLBIIPAS2_HIGH_GFX_ADDR A:0x1f0a634
y.create.l HWIO_GFX_SMMU_CB3_TLBIIPAS2_HIGH_GFX_ADDR A:0x1f0b634
y.create.l HWIO_GFX_SMMU_CB0_TLBIIPAS2L_LOW_GFX_ADDR A:0x1f08638
y.create.l HWIO_GFX_SMMU_CB1_TLBIIPAS2L_LOW_GFX_ADDR A:0x1f09638
y.create.l HWIO_GFX_SMMU_CB2_TLBIIPAS2L_LOW_GFX_ADDR A:0x1f0a638
y.create.l HWIO_GFX_SMMU_CB3_TLBIIPAS2L_LOW_GFX_ADDR A:0x1f0b638
y.create.l HWIO_GFX_SMMU_CB0_TLBIIPAS2L_HIGH_GFX_ADDR A:0x1f0863c
y.create.l HWIO_GFX_SMMU_CB1_TLBIIPAS2L_HIGH_GFX_ADDR A:0x1f0963c
y.create.l HWIO_GFX_SMMU_CB2_TLBIIPAS2L_HIGH_GFX_ADDR A:0x1f0a63c
y.create.l HWIO_GFX_SMMU_CB3_TLBIIPAS2L_HIGH_GFX_ADDR A:0x1f0b63c
y.create.l HWIO_GFX_SMMU_CB0_TLBSYNC_GFX_ADDR A:0x1f087f0
y.create.l HWIO_GFX_SMMU_CB1_TLBSYNC_GFX_ADDR A:0x1f097f0
y.create.l HWIO_GFX_SMMU_CB2_TLBSYNC_GFX_ADDR A:0x1f0a7f0
y.create.l HWIO_GFX_SMMU_CB3_TLBSYNC_GFX_ADDR A:0x1f0b7f0
y.create.l HWIO_GFX_SMMU_CB0_TLBSTATUS_GFX_ADDR A:0x1f087f4
y.create.l HWIO_GFX_SMMU_CB1_TLBSTATUS_GFX_ADDR A:0x1f097f4
y.create.l HWIO_GFX_SMMU_CB2_TLBSTATUS_GFX_ADDR A:0x1f0a7f4
y.create.l HWIO_GFX_SMMU_CB3_TLBSTATUS_GFX_ADDR A:0x1f0b7f4
y.create.l HWIO_GFX_SMMU_CB0_PMEVCNTR0_GFX_ADDR A:0x1f08e00
y.create.l HWIO_GFX_SMMU_CB1_PMEVCNTR0_GFX_ADDR A:0x1f09e00
y.create.l HWIO_GFX_SMMU_CB2_PMEVCNTR0_GFX_ADDR A:0x1f0ae00
y.create.l HWIO_GFX_SMMU_CB3_PMEVCNTR0_GFX_ADDR A:0x1f0be00
y.create.l HWIO_GFX_SMMU_CB0_PMEVCNTR1_GFX_ADDR A:0x1f08e04
y.create.l HWIO_GFX_SMMU_CB1_PMEVCNTR1_GFX_ADDR A:0x1f09e04
y.create.l HWIO_GFX_SMMU_CB2_PMEVCNTR1_GFX_ADDR A:0x1f0ae04
y.create.l HWIO_GFX_SMMU_CB3_PMEVCNTR1_GFX_ADDR A:0x1f0be04
y.create.l HWIO_GFX_SMMU_CB0_PMEVCNTR2_GFX_ADDR A:0x1f08e08
y.create.l HWIO_GFX_SMMU_CB1_PMEVCNTR2_GFX_ADDR A:0x1f09e08
y.create.l HWIO_GFX_SMMU_CB2_PMEVCNTR2_GFX_ADDR A:0x1f0ae08
y.create.l HWIO_GFX_SMMU_CB3_PMEVCNTR2_GFX_ADDR A:0x1f0be08
y.create.l HWIO_GFX_SMMU_CB0_PMEVCNTR3_GFX_ADDR A:0x1f08e0c
y.create.l HWIO_GFX_SMMU_CB1_PMEVCNTR3_GFX_ADDR A:0x1f09e0c
y.create.l HWIO_GFX_SMMU_CB2_PMEVCNTR3_GFX_ADDR A:0x1f0ae0c
y.create.l HWIO_GFX_SMMU_CB3_PMEVCNTR3_GFX_ADDR A:0x1f0be0c
y.create.l HWIO_GFX_SMMU_CB0_PMEVTYPER0_GFX_ADDR A:0x1f08e80
y.create.l HWIO_GFX_SMMU_CB1_PMEVTYPER0_GFX_ADDR A:0x1f09e80
y.create.l HWIO_GFX_SMMU_CB2_PMEVTYPER0_GFX_ADDR A:0x1f0ae80
y.create.l HWIO_GFX_SMMU_CB3_PMEVTYPER0_GFX_ADDR A:0x1f0be80
y.create.l HWIO_GFX_SMMU_CB0_PMEVTYPER1_GFX_ADDR A:0x1f08e84
y.create.l HWIO_GFX_SMMU_CB1_PMEVTYPER1_GFX_ADDR A:0x1f09e84
y.create.l HWIO_GFX_SMMU_CB2_PMEVTYPER1_GFX_ADDR A:0x1f0ae84
y.create.l HWIO_GFX_SMMU_CB3_PMEVTYPER1_GFX_ADDR A:0x1f0be84
y.create.l HWIO_GFX_SMMU_CB0_PMEVTYPER2_GFX_ADDR A:0x1f08e88
y.create.l HWIO_GFX_SMMU_CB1_PMEVTYPER2_GFX_ADDR A:0x1f09e88
y.create.l HWIO_GFX_SMMU_CB2_PMEVTYPER2_GFX_ADDR A:0x1f0ae88
y.create.l HWIO_GFX_SMMU_CB3_PMEVTYPER2_GFX_ADDR A:0x1f0be88
y.create.l HWIO_GFX_SMMU_CB0_PMEVTYPER3_GFX_ADDR A:0x1f08e8c
y.create.l HWIO_GFX_SMMU_CB1_PMEVTYPER3_GFX_ADDR A:0x1f09e8c
y.create.l HWIO_GFX_SMMU_CB2_PMEVTYPER3_GFX_ADDR A:0x1f0ae8c
y.create.l HWIO_GFX_SMMU_CB3_PMEVTYPER3_GFX_ADDR A:0x1f0be8c
y.create.l HWIO_GFX_SMMU_CB0_PMCFGR_GFX_ADDR A:0x1f08f00
y.create.l HWIO_GFX_SMMU_CB1_PMCFGR_GFX_ADDR A:0x1f09f00
y.create.l HWIO_GFX_SMMU_CB2_PMCFGR_GFX_ADDR A:0x1f0af00
y.create.l HWIO_GFX_SMMU_CB3_PMCFGR_GFX_ADDR A:0x1f0bf00
y.create.l HWIO_GFX_SMMU_CB0_PMCR_GFX_ADDR A:0x1f08f04
y.create.l HWIO_GFX_SMMU_CB1_PMCR_GFX_ADDR A:0x1f09f04
y.create.l HWIO_GFX_SMMU_CB2_PMCR_GFX_ADDR A:0x1f0af04
y.create.l HWIO_GFX_SMMU_CB3_PMCR_GFX_ADDR A:0x1f0bf04
y.create.l HWIO_GFX_SMMU_CB0_PMCEID_GFX_ADDR A:0x1f08f20
y.create.l HWIO_GFX_SMMU_CB1_PMCEID_GFX_ADDR A:0x1f09f20
y.create.l HWIO_GFX_SMMU_CB2_PMCEID_GFX_ADDR A:0x1f0af20
y.create.l HWIO_GFX_SMMU_CB3_PMCEID_GFX_ADDR A:0x1f0bf20
y.create.l HWIO_GFX_SMMU_CB0_PMCNTENSE_GFX_ADDR A:0x1f08f40
y.create.l HWIO_GFX_SMMU_CB1_PMCNTENSE_GFX_ADDR A:0x1f09f40
y.create.l HWIO_GFX_SMMU_CB2_PMCNTENSE_GFX_ADDR A:0x1f0af40
y.create.l HWIO_GFX_SMMU_CB3_PMCNTENSE_GFX_ADDR A:0x1f0bf40
y.create.l HWIO_GFX_SMMU_CB0_PMCNTENCLR_GFX_ADDR A:0x1f08f44
y.create.l HWIO_GFX_SMMU_CB1_PMCNTENCLR_GFX_ADDR A:0x1f09f44
y.create.l HWIO_GFX_SMMU_CB2_PMCNTENCLR_GFX_ADDR A:0x1f0af44
y.create.l HWIO_GFX_SMMU_CB3_PMCNTENCLR_GFX_ADDR A:0x1f0bf44
y.create.l HWIO_GFX_SMMU_CB0_PMCNTENSET_GFX_ADDR A:0x1f08f48
y.create.l HWIO_GFX_SMMU_CB1_PMCNTENSET_GFX_ADDR A:0x1f09f48
y.create.l HWIO_GFX_SMMU_CB2_PMCNTENSET_GFX_ADDR A:0x1f0af48
y.create.l HWIO_GFX_SMMU_CB3_PMCNTENSET_GFX_ADDR A:0x1f0bf48
y.create.l HWIO_GFX_SMMU_CB0_PMINTENCLR_GFX_ADDR A:0x1f08f4c
y.create.l HWIO_GFX_SMMU_CB1_PMINTENCLR_GFX_ADDR A:0x1f09f4c
y.create.l HWIO_GFX_SMMU_CB2_PMINTENCLR_GFX_ADDR A:0x1f0af4c
y.create.l HWIO_GFX_SMMU_CB3_PMINTENCLR_GFX_ADDR A:0x1f0bf4c
y.create.l HWIO_GFX_SMMU_CB0_PMOVSCLR_GFX_ADDR A:0x1f08f50
y.create.l HWIO_GFX_SMMU_CB1_PMOVSCLR_GFX_ADDR A:0x1f09f50
y.create.l HWIO_GFX_SMMU_CB2_PMOVSCLR_GFX_ADDR A:0x1f0af50
y.create.l HWIO_GFX_SMMU_CB3_PMOVSCLR_GFX_ADDR A:0x1f0bf50
y.create.l HWIO_GFX_SMMU_CB0_PMOVSSET_GFX_ADDR A:0x1f08f58
y.create.l HWIO_GFX_SMMU_CB1_PMOVSSET_GFX_ADDR A:0x1f09f58
y.create.l HWIO_GFX_SMMU_CB2_PMOVSSET_GFX_ADDR A:0x1f0af58
y.create.l HWIO_GFX_SMMU_CB3_PMOVSSET_GFX_ADDR A:0x1f0bf58
y.create.l HWIO_GFX_SMMU_CB0_PMAUTHSTATUS_GFX_ADDR A:0x1f08fb8
y.create.l HWIO_GFX_SMMU_CB1_PMAUTHSTATUS_GFX_ADDR A:0x1f09fb8
y.create.l HWIO_GFX_SMMU_CB2_PMAUTHSTATUS_GFX_ADDR A:0x1f0afb8
y.create.l HWIO_GFX_SMMU_CB3_PMAUTHSTATUS_GFX_ADDR A:0x1f0bfb8
y.create.l HWIO_GFX_SMMU_CR0_GFX_ADDR A:0x1f00000
y.create.l HWIO_GFX_SMMU_ACR_GFX_ADDR A:0x1f00010
y.create.l HWIO_GFX_SMMU_IDR0_GFX_ADDR A:0x1f00020
y.create.l HWIO_GFX_SMMU_IDR1_GFX_ADDR A:0x1f00024
y.create.l HWIO_GFX_SMMU_IDR2_GFX_ADDR A:0x1f00028
y.create.l HWIO_GFX_SMMU_IDR7_GFX_ADDR A:0x1f0003c
y.create.l HWIO_GFX_SMMU_GFAR_LOW_GFX_ADDR A:0x1f00040
y.create.l HWIO_GFX_SMMU_GFAR_HIGH_GFX_ADDR A:0x1f00044
y.create.l HWIO_GFX_SMMU_GFSR_GFX_ADDR A:0x1f00048
y.create.l HWIO_GFX_SMMU_GFSRRESTORE_GFX_ADDR A:0x1f0004c
y.create.l HWIO_GFX_SMMU_GFSYNR0_GFX_ADDR A:0x1f00050
y.create.l HWIO_GFX_SMMU_GFSYNR1_GFX_ADDR A:0x1f00054
y.create.l HWIO_GFX_SMMU_TLBIVMID_2_GFX_ADDR A:0x1f00064
y.create.l HWIO_GFX_SMMU_TLBIALLNSNH_2_GFX_ADDR A:0x1f00068
y.create.l HWIO_GFX_SMMU_TLBIALLH_GFX_ADDR A:0x1f0006c
y.create.l HWIO_GFX_SMMU_TLBGSYNC_GFX_ADDR A:0x1f00070
y.create.l HWIO_GFX_SMMU_TLBGSTATUS_GFX_ADDR A:0x1f00074
y.create.l HWIO_GFX_SMMU_TLBIVAH_LOW_GFX_ADDR A:0x1f00078
y.create.l HWIO_GFX_SMMU_TLBIVALH64_LOW_GFX_ADDR A:0x1f000b0
y.create.l HWIO_GFX_SMMU_TLBIVALH64_HIGH_GFX_ADDR A:0x1f000b4
y.create.l HWIO_GFX_SMMU_TLBIVMIDS1_GFX_ADDR A:0x1f000b8
y.create.l HWIO_GFX_SMMU_TLBIVAH64_LOW_GFX_ADDR A:0x1f000c0
y.create.l HWIO_GFX_SMMU_TLBIVAH64_HIGH_GFX_ADDR A:0x1f000c4
y.create.l HWIO_GFX_SMMU_SMR0_2_GFX_ADDR A:0x1f00800
y.create.l HWIO_GFX_SMMU_SMR1_2_GFX_ADDR A:0x1f00804
y.create.l HWIO_GFX_SMMU_SMR2_2_GFX_ADDR A:0x1f00808
y.create.l HWIO_GFX_SMMU_SMR3_2_GFX_ADDR A:0x1f0080c
y.create.l HWIO_GFX_SMMU_S2CR0_2_GFX_ADDR A:0x1f00c00
y.create.l HWIO_GFX_SMMU_S2CR1_2_GFX_ADDR A:0x1f00c04
y.create.l HWIO_GFX_SMMU_S2CR2_2_GFX_ADDR A:0x1f00c08
y.create.l HWIO_GFX_SMMU_S2CR3_2_GFX_ADDR A:0x1f00c0c
y.create.l HWIO_GFX_SMMU_PIDR0_2_GFX_ADDR A:0x1f00fe0
y.create.l HWIO_GFX_SMMU_PIDR1_2_GFX_ADDR A:0x1f00fe4
y.create.l HWIO_GFX_SMMU_PIDR2_2_GFX_ADDR A:0x1f00fe8
y.create.l HWIO_GFX_SMMU_PIDR3_2_GFX_ADDR A:0x1f00fec
y.create.l HWIO_GFX_SMMU_PIDR4_2_GFX_ADDR A:0x1f00fd0
y.create.l HWIO_GFX_SMMU_PIDR5_2_GFX_ADDR A:0x1f00fd4
y.create.l HWIO_GFX_SMMU_PIDR6_2_GFX_ADDR A:0x1f00fd8
y.create.l HWIO_GFX_SMMU_PIDR7_2_GFX_ADDR A:0x1f00fdc
y.create.l HWIO_GFX_SMMU_CIDR0_2_GFX_ADDR A:0x1f00ff0
y.create.l HWIO_GFX_SMMU_CIDR1_2_GFX_ADDR A:0x1f00ff4
y.create.l HWIO_GFX_SMMU_CIDR2_2_GFX_ADDR A:0x1f00ff8
y.create.l HWIO_GFX_SMMU_CIDR3_2_GFX_ADDR A:0x1f00ffc
y.create.l HWIO_GFX_SMMU_CBAR0_2_GFX_ADDR A:0x1f01000
y.create.l HWIO_GFX_SMMU_CBFRSYNRA0_2_GFX_ADDR A:0x1f01400
y.create.l HWIO_GFX_SMMU_CBA2R0_2_GFX_ADDR A:0x1f01800
y.create.l HWIO_GFX_SMMU_CBAR1_2_GFX_ADDR A:0x1f01004
y.create.l HWIO_GFX_SMMU_CBFRSYNRA1_2_GFX_ADDR A:0x1f01404
y.create.l HWIO_GFX_SMMU_CBA2R1_2_GFX_ADDR A:0x1f01804
y.create.l HWIO_GFX_SMMU_CBAR2_2_GFX_ADDR A:0x1f01008
y.create.l HWIO_GFX_SMMU_CBFRSYNRA2_2_GFX_ADDR A:0x1f01408
y.create.l HWIO_GFX_SMMU_CBA2R2_2_GFX_ADDR A:0x1f01808
y.create.l HWIO_GFX_SMMU_CBAR3_2_GFX_ADDR A:0x1f0100c
y.create.l HWIO_GFX_SMMU_CBFRSYNRA3_2_GFX_ADDR A:0x1f0140c
y.create.l HWIO_GFX_SMMU_CBA2R3_2_GFX_ADDR A:0x1f0180c
y.create.l HWIO_GFX_PMEVCNTR0_2_GFX_ADDR A:0x1f03000
y.create.l HWIO_GFX_PMEVCNTR1_2_GFX_ADDR A:0x1f03004
y.create.l HWIO_GFX_PMEVCNTR2_2_GFX_ADDR A:0x1f03008
y.create.l HWIO_GFX_PMEVCNTR3_2_GFX_ADDR A:0x1f0300c
y.create.l HWIO_GFX_PMEVTYPER0_2_GFX_ADDR A:0x1f03400
y.create.l HWIO_GFX_PMEVTYPER1_2_GFX_ADDR A:0x1f03404
y.create.l HWIO_GFX_PMEVTYPER2_2_GFX_ADDR A:0x1f03408
y.create.l HWIO_GFX_PMEVTYPER3_2_GFX_ADDR A:0x1f0340c
y.create.l HWIO_GFX_PMCGCR_2_GFX_ADDR A:0x1f03800
y.create.l HWIO_GFX_PMCGSMR_2_GFX_ADDR A:0x1f03a00
y.create.l HWIO_GFX_PMCNTENSET_2_GFX_ADDR A:0x1f03c00
y.create.l HWIO_GFX_PMCNTENCLR_2_GFX_ADDR A:0x1f03c20
y.create.l HWIO_GFX_PMINTENSET_2_GFX_ADDR A:0x1f03c40
y.create.l HWIO_GFX_PMINTENCLR_2_GFX_ADDR A:0x1f03c60
y.create.l HWIO_GFX_PMOVSCLR_2_GFX_ADDR A:0x1f03c80
y.create.l HWIO_GFX_PMOVSSET_2_GFX_ADDR A:0x1f03cc0
y.create.l HWIO_GFX_PMCFGR_2_GFX_ADDR A:0x1f03e00
y.create.l HWIO_GFX_PMCR_2_GFX_ADDR A:0x1f03e04
y.create.l HWIO_GFX_PMCEID0_2_GFX_ADDR A:0x1f03e20
y.create.l HWIO_GFX_PMAUTHSTATUS_2_GFX_ADDR A:0x1f03fb8
y.create.l HWIO_GFX_PMDEVTYPE_2_GFX_ADDR A:0x1f03fcc
y.create.l HWIO_GFX_SMMU_CB0_SCTLR_2_GFX_ADDR A:0x1f08000
y.create.l HWIO_GFX_SMMU_CB1_SCTLR_2_GFX_ADDR A:0x1f09000
y.create.l HWIO_GFX_SMMU_CB2_SCTLR_2_GFX_ADDR A:0x1f0a000
y.create.l HWIO_GFX_SMMU_CB3_SCTLR_2_GFX_ADDR A:0x1f0b000
y.create.l HWIO_GFX_SMMU_CB0_ACTLR_2_GFX_ADDR A:0x1f08004
y.create.l HWIO_GFX_SMMU_CB1_ACTLR_2_GFX_ADDR A:0x1f09004
y.create.l HWIO_GFX_SMMU_CB2_ACTLR_2_GFX_ADDR A:0x1f0a004
y.create.l HWIO_GFX_SMMU_CB3_ACTLR_2_GFX_ADDR A:0x1f0b004
y.create.l HWIO_GFX_SMMU_CB0_RESUME_2_GFX_ADDR A:0x1f08008
y.create.l HWIO_GFX_SMMU_CB1_RESUME_2_GFX_ADDR A:0x1f09008
y.create.l HWIO_GFX_SMMU_CB2_RESUME_2_GFX_ADDR A:0x1f0a008
y.create.l HWIO_GFX_SMMU_CB3_RESUME_2_GFX_ADDR A:0x1f0b008
y.create.l HWIO_GFX_SMMU_CB0_TCR2_2_GFX_ADDR A:0x1f08010
y.create.l HWIO_GFX_SMMU_CB1_TCR2_2_GFX_ADDR A:0x1f09010
y.create.l HWIO_GFX_SMMU_CB2_TCR2_2_GFX_ADDR A:0x1f0a010
y.create.l HWIO_GFX_SMMU_CB3_TCR2_2_GFX_ADDR A:0x1f0b010
y.create.l HWIO_GFX_SMMU_CB0_TTBR0_LOW_2_GFX_ADDR A:0x1f08020
y.create.l HWIO_GFX_SMMU_CB1_TTBR0_LOW_2_GFX_ADDR A:0x1f09020
y.create.l HWIO_GFX_SMMU_CB2_TTBR0_LOW_2_GFX_ADDR A:0x1f0a020
y.create.l HWIO_GFX_SMMU_CB3_TTBR0_LOW_2_GFX_ADDR A:0x1f0b020
y.create.l HWIO_GFX_SMMU_CB0_TTBR0_HIGH_2_GFX_ADDR A:0x1f08024
y.create.l HWIO_GFX_SMMU_CB1_TTBR0_HIGH_2_GFX_ADDR A:0x1f09024
y.create.l HWIO_GFX_SMMU_CB2_TTBR0_HIGH_2_GFX_ADDR A:0x1f0a024
y.create.l HWIO_GFX_SMMU_CB3_TTBR0_HIGH_2_GFX_ADDR A:0x1f0b024
y.create.l HWIO_GFX_SMMU_CB0_TTBR1_LOW_2_GFX_ADDR A:0x1f08028
y.create.l HWIO_GFX_SMMU_CB1_TTBR1_LOW_2_GFX_ADDR A:0x1f09028
y.create.l HWIO_GFX_SMMU_CB2_TTBR1_LOW_2_GFX_ADDR A:0x1f0a028
y.create.l HWIO_GFX_SMMU_CB3_TTBR1_LOW_2_GFX_ADDR A:0x1f0b028
y.create.l HWIO_GFX_SMMU_CB0_TTBR1_HIGH_2_GFX_ADDR A:0x1f0802c
y.create.l HWIO_GFX_SMMU_CB1_TTBR1_HIGH_2_GFX_ADDR A:0x1f0902c
y.create.l HWIO_GFX_SMMU_CB2_TTBR1_HIGH_2_GFX_ADDR A:0x1f0a02c
y.create.l HWIO_GFX_SMMU_CB3_TTBR1_HIGH_2_GFX_ADDR A:0x1f0b02c
y.create.l HWIO_GFX_SMMU_CB0_TCR_LPAE_2_GFX_ADDR A:0x1f08030
y.create.l HWIO_GFX_SMMU_CB1_TCR_LPAE_2_GFX_ADDR A:0x1f09030
y.create.l HWIO_GFX_SMMU_CB2_TCR_LPAE_2_GFX_ADDR A:0x1f0a030
y.create.l HWIO_GFX_SMMU_CB3_TCR_LPAE_2_GFX_ADDR A:0x1f0b030
y.create.l HWIO_GFX_SMMU_CB0_CONTEXTIDR_2_GFX_ADDR A:0x1f08034
y.create.l HWIO_GFX_SMMU_CB1_CONTEXTIDR_2_GFX_ADDR A:0x1f09034
y.create.l HWIO_GFX_SMMU_CB2_CONTEXTIDR_2_GFX_ADDR A:0x1f0a034
y.create.l HWIO_GFX_SMMU_CB3_CONTEXTIDR_2_GFX_ADDR A:0x1f0b034
y.create.l HWIO_GFX_SMMU_CB0_PRRR_MAIR0_2_GFX_ADDR A:0x1f08038
y.create.l HWIO_GFX_SMMU_CB1_PRRR_MAIR0_2_GFX_ADDR A:0x1f09038
y.create.l HWIO_GFX_SMMU_CB2_PRRR_MAIR0_2_GFX_ADDR A:0x1f0a038
y.create.l HWIO_GFX_SMMU_CB3_PRRR_MAIR0_2_GFX_ADDR A:0x1f0b038
y.create.l HWIO_GFX_SMMU_CB0_NMRR_MAIR1_2_GFX_ADDR A:0x1f0803c
y.create.l HWIO_GFX_SMMU_CB1_NMRR_MAIR1_2_GFX_ADDR A:0x1f0903c
y.create.l HWIO_GFX_SMMU_CB2_NMRR_MAIR1_2_GFX_ADDR A:0x1f0a03c
y.create.l HWIO_GFX_SMMU_CB3_NMRR_MAIR1_2_GFX_ADDR A:0x1f0b03c
y.create.l HWIO_GFX_SMMU_CB0_FSR_2_GFX_ADDR A:0x1f08058
y.create.l HWIO_GFX_SMMU_CB1_FSR_2_GFX_ADDR A:0x1f09058
y.create.l HWIO_GFX_SMMU_CB2_FSR_2_GFX_ADDR A:0x1f0a058
y.create.l HWIO_GFX_SMMU_CB3_FSR_2_GFX_ADDR A:0x1f0b058
y.create.l HWIO_GFX_SMMU_CB0_FSRRESTORE_2_GFX_ADDR A:0x1f0805c
y.create.l HWIO_GFX_SMMU_CB1_FSRRESTORE_2_GFX_ADDR A:0x1f0905c
y.create.l HWIO_GFX_SMMU_CB2_FSRRESTORE_2_GFX_ADDR A:0x1f0a05c
y.create.l HWIO_GFX_SMMU_CB3_FSRRESTORE_2_GFX_ADDR A:0x1f0b05c
y.create.l HWIO_GFX_SMMU_CB0_FAR_LOW_2_GFX_ADDR A:0x1f08060
y.create.l HWIO_GFX_SMMU_CB1_FAR_LOW_2_GFX_ADDR A:0x1f09060
y.create.l HWIO_GFX_SMMU_CB2_FAR_LOW_2_GFX_ADDR A:0x1f0a060
y.create.l HWIO_GFX_SMMU_CB3_FAR_LOW_2_GFX_ADDR A:0x1f0b060
y.create.l HWIO_GFX_SMMU_CB0_FAR_HIGH_2_GFX_ADDR A:0x1f08064
y.create.l HWIO_GFX_SMMU_CB1_FAR_HIGH_2_GFX_ADDR A:0x1f09064
y.create.l HWIO_GFX_SMMU_CB2_FAR_HIGH_2_GFX_ADDR A:0x1f0a064
y.create.l HWIO_GFX_SMMU_CB3_FAR_HIGH_2_GFX_ADDR A:0x1f0b064
y.create.l HWIO_GFX_SMMU_CB0_FSYNR0_2_GFX_ADDR A:0x1f08068
y.create.l HWIO_GFX_SMMU_CB1_FSYNR0_2_GFX_ADDR A:0x1f09068
y.create.l HWIO_GFX_SMMU_CB2_FSYNR0_2_GFX_ADDR A:0x1f0a068
y.create.l HWIO_GFX_SMMU_CB3_FSYNR0_2_GFX_ADDR A:0x1f0b068
y.create.l HWIO_GFX_SMMU_CB0_IPAFAR_LOW_2_GFX_ADDR A:0x1f08070
y.create.l HWIO_GFX_SMMU_CB1_IPAFAR_LOW_2_GFX_ADDR A:0x1f09070
y.create.l HWIO_GFX_SMMU_CB2_IPAFAR_LOW_2_GFX_ADDR A:0x1f0a070
y.create.l HWIO_GFX_SMMU_CB3_IPAFAR_LOW_2_GFX_ADDR A:0x1f0b070
y.create.l HWIO_GFX_SMMU_CB0_IPAFAR_HIGH_2_GFX_ADDR A:0x1f08074
y.create.l HWIO_GFX_SMMU_CB1_IPAFAR_HIGH_2_GFX_ADDR A:0x1f09074
y.create.l HWIO_GFX_SMMU_CB2_IPAFAR_HIGH_2_GFX_ADDR A:0x1f0a074
y.create.l HWIO_GFX_SMMU_CB3_IPAFAR_HIGH_2_GFX_ADDR A:0x1f0b074
y.create.l HWIO_GFX_SMMU_CB0_TLBIVA_LOW_2_GFX_ADDR A:0x1f08600
y.create.l HWIO_GFX_SMMU_CB1_TLBIVA_LOW_2_GFX_ADDR A:0x1f09600
y.create.l HWIO_GFX_SMMU_CB2_TLBIVA_LOW_2_GFX_ADDR A:0x1f0a600
y.create.l HWIO_GFX_SMMU_CB3_TLBIVA_LOW_2_GFX_ADDR A:0x1f0b600
y.create.l HWIO_GFX_SMMU_CB0_TLBIVA_HIGH_2_GFX_ADDR A:0x1f08604
y.create.l HWIO_GFX_SMMU_CB1_TLBIVA_HIGH_2_GFX_ADDR A:0x1f09604
y.create.l HWIO_GFX_SMMU_CB2_TLBIVA_HIGH_2_GFX_ADDR A:0x1f0a604
y.create.l HWIO_GFX_SMMU_CB3_TLBIVA_HIGH_2_GFX_ADDR A:0x1f0b604
y.create.l HWIO_GFX_SMMU_CB0_TLBIVAA_LOW_2_GFX_ADDR A:0x1f08608
y.create.l HWIO_GFX_SMMU_CB1_TLBIVAA_LOW_2_GFX_ADDR A:0x1f09608
y.create.l HWIO_GFX_SMMU_CB2_TLBIVAA_LOW_2_GFX_ADDR A:0x1f0a608
y.create.l HWIO_GFX_SMMU_CB3_TLBIVAA_LOW_2_GFX_ADDR A:0x1f0b608
y.create.l HWIO_GFX_SMMU_CB0_TLBIVAA_HIGH_2_GFX_ADDR A:0x1f0860c
y.create.l HWIO_GFX_SMMU_CB1_TLBIVAA_HIGH_2_GFX_ADDR A:0x1f0960c
y.create.l HWIO_GFX_SMMU_CB2_TLBIVAA_HIGH_2_GFX_ADDR A:0x1f0a60c
y.create.l HWIO_GFX_SMMU_CB3_TLBIVAA_HIGH_2_GFX_ADDR A:0x1f0b60c
y.create.l HWIO_GFX_SMMU_CB0_TLBIASID_2_GFX_ADDR A:0x1f08610
y.create.l HWIO_GFX_SMMU_CB1_TLBIASID_2_GFX_ADDR A:0x1f09610
y.create.l HWIO_GFX_SMMU_CB2_TLBIASID_2_GFX_ADDR A:0x1f0a610
y.create.l HWIO_GFX_SMMU_CB3_TLBIASID_2_GFX_ADDR A:0x1f0b610
y.create.l HWIO_GFX_SMMU_CB0_TLBIALL_2_GFX_ADDR A:0x1f08618
y.create.l HWIO_GFX_SMMU_CB1_TLBIALL_2_GFX_ADDR A:0x1f09618
y.create.l HWIO_GFX_SMMU_CB2_TLBIALL_2_GFX_ADDR A:0x1f0a618
y.create.l HWIO_GFX_SMMU_CB3_TLBIALL_2_GFX_ADDR A:0x1f0b618
y.create.l HWIO_GFX_SMMU_CB0_TLBIVAL_LOW_2_GFX_ADDR A:0x1f08620
y.create.l HWIO_GFX_SMMU_CB1_TLBIVAL_LOW_2_GFX_ADDR A:0x1f09620
y.create.l HWIO_GFX_SMMU_CB2_TLBIVAL_LOW_2_GFX_ADDR A:0x1f0a620
y.create.l HWIO_GFX_SMMU_CB3_TLBIVAL_LOW_2_GFX_ADDR A:0x1f0b620
y.create.l HWIO_GFX_SMMU_CB0_TLBIVAL_HIGH_2_GFX_ADDR A:0x1f08624
y.create.l HWIO_GFX_SMMU_CB1_TLBIVAL_HIGH_2_GFX_ADDR A:0x1f09624
y.create.l HWIO_GFX_SMMU_CB2_TLBIVAL_HIGH_2_GFX_ADDR A:0x1f0a624
y.create.l HWIO_GFX_SMMU_CB3_TLBIVAL_HIGH_2_GFX_ADDR A:0x1f0b624
y.create.l HWIO_GFX_SMMU_CB0_TLBIVAAL_LOW_2_GFX_ADDR A:0x1f08628
y.create.l HWIO_GFX_SMMU_CB1_TLBIVAAL_LOW_2_GFX_ADDR A:0x1f09628
y.create.l HWIO_GFX_SMMU_CB2_TLBIVAAL_LOW_2_GFX_ADDR A:0x1f0a628
y.create.l HWIO_GFX_SMMU_CB3_TLBIVAAL_LOW_2_GFX_ADDR A:0x1f0b628
y.create.l HWIO_GFX_SMMU_CB0_TLBIVAAL_HIGH_2_GFX_ADDR A:0x1f0862c
y.create.l HWIO_GFX_SMMU_CB1_TLBIVAAL_HIGH_2_GFX_ADDR A:0x1f0962c
y.create.l HWIO_GFX_SMMU_CB2_TLBIVAAL_HIGH_2_GFX_ADDR A:0x1f0a62c
y.create.l HWIO_GFX_SMMU_CB3_TLBIVAAL_HIGH_2_GFX_ADDR A:0x1f0b62c
y.create.l HWIO_GFX_SMMU_CB0_TLBIIPAS2_LOW_2_GFX_ADDR A:0x1f08630
y.create.l HWIO_GFX_SMMU_CB1_TLBIIPAS2_LOW_2_GFX_ADDR A:0x1f09630
y.create.l HWIO_GFX_SMMU_CB2_TLBIIPAS2_LOW_2_GFX_ADDR A:0x1f0a630
y.create.l HWIO_GFX_SMMU_CB3_TLBIIPAS2_LOW_2_GFX_ADDR A:0x1f0b630
y.create.l HWIO_GFX_SMMU_CB0_TLBIIPAS2_HIGH_2_GFX_ADDR A:0x1f08634
y.create.l HWIO_GFX_SMMU_CB1_TLBIIPAS2_HIGH_2_GFX_ADDR A:0x1f09634
y.create.l HWIO_GFX_SMMU_CB2_TLBIIPAS2_HIGH_2_GFX_ADDR A:0x1f0a634
y.create.l HWIO_GFX_SMMU_CB3_TLBIIPAS2_HIGH_2_GFX_ADDR A:0x1f0b634
y.create.l HWIO_GFX_SMMU_CB0_TLBIIPAS2L_LOW_2_GFX_ADDR A:0x1f08638
y.create.l HWIO_GFX_SMMU_CB1_TLBIIPAS2L_LOW_2_GFX_ADDR A:0x1f09638
y.create.l HWIO_GFX_SMMU_CB2_TLBIIPAS2L_LOW_2_GFX_ADDR A:0x1f0a638
y.create.l HWIO_GFX_SMMU_CB3_TLBIIPAS2L_LOW_2_GFX_ADDR A:0x1f0b638
y.create.l HWIO_GFX_SMMU_CB0_TLBIIPAS2L_HIGH_2_GFX_ADDR A:0x1f0863c
y.create.l HWIO_GFX_SMMU_CB1_TLBIIPAS2L_HIGH_2_GFX_ADDR A:0x1f0963c
y.create.l HWIO_GFX_SMMU_CB2_TLBIIPAS2L_HIGH_2_GFX_ADDR A:0x1f0a63c
y.create.l HWIO_GFX_SMMU_CB3_TLBIIPAS2L_HIGH_2_GFX_ADDR A:0x1f0b63c
y.create.l HWIO_GFX_SMMU_CB0_TLBSYNC_2_GFX_ADDR A:0x1f087f0
y.create.l HWIO_GFX_SMMU_CB1_TLBSYNC_2_GFX_ADDR A:0x1f097f0
y.create.l HWIO_GFX_SMMU_CB2_TLBSYNC_2_GFX_ADDR A:0x1f0a7f0
y.create.l HWIO_GFX_SMMU_CB3_TLBSYNC_2_GFX_ADDR A:0x1f0b7f0
y.create.l HWIO_GFX_SMMU_CB0_TLBSTATUS_2_GFX_ADDR A:0x1f087f4
y.create.l HWIO_GFX_SMMU_CB1_TLBSTATUS_2_GFX_ADDR A:0x1f097f4
y.create.l HWIO_GFX_SMMU_CB2_TLBSTATUS_2_GFX_ADDR A:0x1f0a7f4
y.create.l HWIO_GFX_SMMU_CB3_TLBSTATUS_2_GFX_ADDR A:0x1f0b7f4
y.create.l HWIO_GFX_SMMU_CB0_PMEVCNTR0_2_GFX_ADDR A:0x1f08e00
y.create.l HWIO_GFX_SMMU_CB1_PMEVCNTR0_2_GFX_ADDR A:0x1f09e00
y.create.l HWIO_GFX_SMMU_CB2_PMEVCNTR0_2_GFX_ADDR A:0x1f0ae00
y.create.l HWIO_GFX_SMMU_CB3_PMEVCNTR0_2_GFX_ADDR A:0x1f0be00
y.create.l HWIO_GFX_SMMU_CB0_PMEVCNTR1_2_GFX_ADDR A:0x1f08e04
y.create.l HWIO_GFX_SMMU_CB1_PMEVCNTR1_2_GFX_ADDR A:0x1f09e04
y.create.l HWIO_GFX_SMMU_CB2_PMEVCNTR1_2_GFX_ADDR A:0x1f0ae04
y.create.l HWIO_GFX_SMMU_CB3_PMEVCNTR1_2_GFX_ADDR A:0x1f0be04
y.create.l HWIO_GFX_SMMU_CB0_PMEVCNTR2_2_GFX_ADDR A:0x1f08e08
y.create.l HWIO_GFX_SMMU_CB1_PMEVCNTR2_2_GFX_ADDR A:0x1f09e08
y.create.l HWIO_GFX_SMMU_CB2_PMEVCNTR2_2_GFX_ADDR A:0x1f0ae08
y.create.l HWIO_GFX_SMMU_CB3_PMEVCNTR2_2_GFX_ADDR A:0x1f0be08
y.create.l HWIO_GFX_SMMU_CB0_PMEVCNTR3_2_GFX_ADDR A:0x1f08e0c
y.create.l HWIO_GFX_SMMU_CB1_PMEVCNTR3_2_GFX_ADDR A:0x1f09e0c
y.create.l HWIO_GFX_SMMU_CB2_PMEVCNTR3_2_GFX_ADDR A:0x1f0ae0c
y.create.l HWIO_GFX_SMMU_CB3_PMEVCNTR3_2_GFX_ADDR A:0x1f0be0c
y.create.l HWIO_GFX_SMMU_CB0_PMEVTYPER0_2_GFX_ADDR A:0x1f08e80
y.create.l HWIO_GFX_SMMU_CB1_PMEVTYPER0_2_GFX_ADDR A:0x1f09e80
y.create.l HWIO_GFX_SMMU_CB2_PMEVTYPER0_2_GFX_ADDR A:0x1f0ae80
y.create.l HWIO_GFX_SMMU_CB3_PMEVTYPER0_2_GFX_ADDR A:0x1f0be80
y.create.l HWIO_GFX_SMMU_CB0_PMEVTYPER1_2_GFX_ADDR A:0x1f08e84
y.create.l HWIO_GFX_SMMU_CB1_PMEVTYPER1_2_GFX_ADDR A:0x1f09e84
y.create.l HWIO_GFX_SMMU_CB2_PMEVTYPER1_2_GFX_ADDR A:0x1f0ae84
y.create.l HWIO_GFX_SMMU_CB3_PMEVTYPER1_2_GFX_ADDR A:0x1f0be84
y.create.l HWIO_GFX_SMMU_CB0_PMEVTYPER2_2_GFX_ADDR A:0x1f08e88
y.create.l HWIO_GFX_SMMU_CB1_PMEVTYPER2_2_GFX_ADDR A:0x1f09e88
y.create.l HWIO_GFX_SMMU_CB2_PMEVTYPER2_2_GFX_ADDR A:0x1f0ae88
y.create.l HWIO_GFX_SMMU_CB3_PMEVTYPER2_2_GFX_ADDR A:0x1f0be88
y.create.l HWIO_GFX_SMMU_CB0_PMEVTYPER3_2_GFX_ADDR A:0x1f08e8c
y.create.l HWIO_GFX_SMMU_CB1_PMEVTYPER3_2_GFX_ADDR A:0x1f09e8c
y.create.l HWIO_GFX_SMMU_CB2_PMEVTYPER3_2_GFX_ADDR A:0x1f0ae8c
y.create.l HWIO_GFX_SMMU_CB3_PMEVTYPER3_2_GFX_ADDR A:0x1f0be8c
y.create.l HWIO_GFX_SMMU_CB0_PMCFGR_2_GFX_ADDR A:0x1f08f00
y.create.l HWIO_GFX_SMMU_CB1_PMCFGR_2_GFX_ADDR A:0x1f09f00
y.create.l HWIO_GFX_SMMU_CB2_PMCFGR_2_GFX_ADDR A:0x1f0af00
y.create.l HWIO_GFX_SMMU_CB3_PMCFGR_2_GFX_ADDR A:0x1f0bf00
y.create.l HWIO_GFX_SMMU_CB0_PMCR_2_GFX_ADDR A:0x1f08f04
y.create.l HWIO_GFX_SMMU_CB1_PMCR_2_GFX_ADDR A:0x1f09f04
y.create.l HWIO_GFX_SMMU_CB2_PMCR_2_GFX_ADDR A:0x1f0af04
y.create.l HWIO_GFX_SMMU_CB3_PMCR_2_GFX_ADDR A:0x1f0bf04
y.create.l HWIO_GFX_SMMU_CB0_PMCEID_2_GFX_ADDR A:0x1f08f20
y.create.l HWIO_GFX_SMMU_CB1_PMCEID_2_GFX_ADDR A:0x1f09f20
y.create.l HWIO_GFX_SMMU_CB2_PMCEID_2_GFX_ADDR A:0x1f0af20
y.create.l HWIO_GFX_SMMU_CB3_PMCEID_2_GFX_ADDR A:0x1f0bf20
y.create.l HWIO_GFX_SMMU_CB0_PMCNTENSE_2_GFX_ADDR A:0x1f08f40
y.create.l HWIO_GFX_SMMU_CB1_PMCNTENSE_2_GFX_ADDR A:0x1f09f40
y.create.l HWIO_GFX_SMMU_CB2_PMCNTENSE_2_GFX_ADDR A:0x1f0af40
y.create.l HWIO_GFX_SMMU_CB3_PMCNTENSE_2_GFX_ADDR A:0x1f0bf40
y.create.l HWIO_GFX_SMMU_CB0_PMCNTENCLR_2_GFX_ADDR A:0x1f08f44
y.create.l HWIO_GFX_SMMU_CB1_PMCNTENCLR_2_GFX_ADDR A:0x1f09f44
y.create.l HWIO_GFX_SMMU_CB2_PMCNTENCLR_2_GFX_ADDR A:0x1f0af44
y.create.l HWIO_GFX_SMMU_CB3_PMCNTENCLR_2_GFX_ADDR A:0x1f0bf44
y.create.l HWIO_GFX_SMMU_CB0_PMCNTENSET_2_GFX_ADDR A:0x1f08f48
y.create.l HWIO_GFX_SMMU_CB1_PMCNTENSET_2_GFX_ADDR A:0x1f09f48
y.create.l HWIO_GFX_SMMU_CB2_PMCNTENSET_2_GFX_ADDR A:0x1f0af48
y.create.l HWIO_GFX_SMMU_CB3_PMCNTENSET_2_GFX_ADDR A:0x1f0bf48
y.create.l HWIO_GFX_SMMU_CB0_PMINTENCLR_2_GFX_ADDR A:0x1f08f4c
y.create.l HWIO_GFX_SMMU_CB1_PMINTENCLR_2_GFX_ADDR A:0x1f09f4c
y.create.l HWIO_GFX_SMMU_CB2_PMINTENCLR_2_GFX_ADDR A:0x1f0af4c
y.create.l HWIO_GFX_SMMU_CB3_PMINTENCLR_2_GFX_ADDR A:0x1f0bf4c
y.create.l HWIO_GFX_SMMU_CB0_PMOVSCLR_2_GFX_ADDR A:0x1f08f50
y.create.l HWIO_GFX_SMMU_CB1_PMOVSCLR_2_GFX_ADDR A:0x1f09f50
y.create.l HWIO_GFX_SMMU_CB2_PMOVSCLR_2_GFX_ADDR A:0x1f0af50
y.create.l HWIO_GFX_SMMU_CB3_PMOVSCLR_2_GFX_ADDR A:0x1f0bf50
y.create.l HWIO_GFX_SMMU_CB0_PMOVSSET_2_GFX_ADDR A:0x1f08f58
y.create.l HWIO_GFX_SMMU_CB1_PMOVSSET_2_GFX_ADDR A:0x1f09f58
y.create.l HWIO_GFX_SMMU_CB2_PMOVSSET_2_GFX_ADDR A:0x1f0af58
y.create.l HWIO_GFX_SMMU_CB3_PMOVSSET_2_GFX_ADDR A:0x1f0bf58
y.create.l HWIO_GFX_SMMU_CB0_PMAUTHSTATUS_2_GFX_ADDR A:0x1f08fb8
y.create.l HWIO_GFX_SMMU_CB1_PMAUTHSTATUS_2_GFX_ADDR A:0x1f09fb8
y.create.l HWIO_GFX_SMMU_CB2_PMAUTHSTATUS_2_GFX_ADDR A:0x1f0afb8
y.create.l HWIO_GFX_SMMU_CB3_PMAUTHSTATUS_2_GFX_ADDR A:0x1f0bfb8
y.create.l HWIO_SNOC_0_ABT_HW_VERSION_ADDR A:0x8801000
y.create.l HWIO_SNOC_0_ABT_INST_ID_ADDR A:0x8801004
y.create.l HWIO_SNOC_0_ABT_NUM_SLAVES_ADDR A:0x8801008
y.create.l HWIO_SNOC_0_ABT_TIMER_LOADVAL_ADDR A:0x880100c
y.create.l HWIO_SNOC_0_ABT_TIMER_MODE_ADDR A:0x8801010
y.create.l HWIO_SNOC_0_ABT_INTR_STATUS_ADDR A:0x8801014
y.create.l HWIO_SNOC_0_ABT_INTR_CLEAR_ADDR A:0x8801018
y.create.l HWIO_SNOC_0_ABT_INTR_ENABLE_ADDR A:0x880101c
y.create.l HWIO_SNOC_0_ABT_SYND_VALID_ADDR A:0x8801020
y.create.l HWIO_SNOC_0_ABT_SYND_CLEAR_ADDR A:0x8801024
y.create.l HWIO_SNOC_0_ABT_SYND_ID_ADDR A:0x8801028
y.create.l HWIO_SNOC_0_ABT_SYND_ADDR0_ADDR A:0x880102c
y.create.l HWIO_SNOC_0_ABT_SYND_ADDR1_ADDR A:0x8801030
y.create.l HWIO_SNOC_0_ABT_SYND_HREADY_ADDR A:0x8801034
y.create.l HWIO_SNOC_1_ABT_HW_VERSION_ADDR A:0x8800000
y.create.l HWIO_SNOC_1_ABT_INST_ID_ADDR A:0x8800004
y.create.l HWIO_SNOC_1_ABT_NUM_SLAVES_ADDR A:0x8800008
y.create.l HWIO_SNOC_1_ABT_TIMER_LOADVAL_ADDR A:0x880000c
y.create.l HWIO_SNOC_1_ABT_TIMER_MODE_ADDR A:0x8800010
y.create.l HWIO_SNOC_1_ABT_INTR_STATUS_ADDR A:0x8800014
y.create.l HWIO_SNOC_1_ABT_INTR_CLEAR_ADDR A:0x8800018
y.create.l HWIO_SNOC_1_ABT_INTR_ENABLE_ADDR A:0x880001c
y.create.l HWIO_SNOC_1_ABT_SYND_VALID_ADDR A:0x8800020
y.create.l HWIO_SNOC_1_ABT_SYND_CLEAR_ADDR A:0x8800024
y.create.l HWIO_SNOC_1_ABT_SYND_ID_ADDR A:0x8800028
y.create.l HWIO_SNOC_1_ABT_SYND_ADDR0_ADDR A:0x880002c
y.create.l HWIO_SNOC_1_ABT_SYND_ADDR1_ADDR A:0x8800030
y.create.l HWIO_SNOC_1_ABT_SYND_HREADY_ADDR A:0x8800034
y.create.l HWIO_SPDM_CREG_CFG0_ADDR A:0x40000
y.create.l HWIO_SPDM_CREG_HW_INFO_ADDR A:0x40004
y.create.l HWIO_SPDM_CREG_HW_VERSION_ADDR A:0x40008
y.create.l HWIO_SPDM_CREG_MUTEX_0_ADDR A:0x40100
y.create.l HWIO_SPDM_OLEM_CFG0_ADDR A:0x41000
y.create.l HWIO_SPDM_OLEM_CFG1_ADDR A:0x41004
y.create.l HWIO_SPDM_OLEM_CFG2_ADDR A:0x41008
y.create.l HWIO_SPDM_OLEM_CFG3_ADDR A:0x4100c
y.create.l HWIO_SPDM_OLEM_CFG4_ADDR A:0x41010
y.create.l HWIO_SPDM_OLEM_CFG5_ADDR A:0x41014
y.create.l HWIO_SPDM_OLEM_CFG6_ADDR A:0x41018
y.create.l HWIO_SPDM_OLEM_CYCLE_C0_OUT_ADDR A:0x41020
y.create.l HWIO_SPDM_OLEM_CYCLE_C1_OUT_ADDR A:0x41024
y.create.l HWIO_SPDM_OLEM_CYCLE_C2_OUT_ADDR A:0x41028
y.create.l HWIO_SPDM_OLEM_CYCLE_C3_OUT_ADDR A:0x4102c
y.create.l HWIO_SPDM_OLEM_CYCLE_C4_OUT_ADDR A:0x41030
y.create.l HWIO_SPDM_OLEM_CYCLE_C5_OUT_ADDR A:0x41034
y.create.l HWIO_SPDM_OLEM_CYCLE_C6_OUT_ADDR A:0x41038
y.create.l HWIO_SPDM_OLEM_CYCLE_C7_OUT_ADDR A:0x4103c
y.create.l HWIO_SPDM_OLEM_CYCLE_C8_OUT_ADDR A:0x41040
y.create.l HWIO_SPDM_OLEM_CYCLE_C9_OUT_ADDR A:0x41044
y.create.l HWIO_SPDM_OLEM_EVENT_C0_OUT_ADDR A:0x410a0
y.create.l HWIO_SPDM_OLEM_EVENT_C1_OUT_ADDR A:0x410a4
y.create.l HWIO_SPDM_OLEM_EVENT_C2_OUT_ADDR A:0x410a8
y.create.l HWIO_SPDM_OLEM_EVENT_C3_OUT_ADDR A:0x410ac
y.create.l HWIO_SPDM_OLEM_EVENT_C4_OUT_ADDR A:0x410b0
y.create.l HWIO_SPDM_OLEM_EVENT_C5_OUT_ADDR A:0x410b4
y.create.l HWIO_SPDM_OLEM_EVENT_C6_OUT_ADDR A:0x410b8
y.create.l HWIO_SPDM_OLEM_EVENT_C7_OUT_ADDR A:0x410bc
y.create.l HWIO_SPDM_OLEM_EVENT_C8_OUT_ADDR A:0x410c0
y.create.l HWIO_SPDM_OLEM_EVENT_C9_OUT_ADDR A:0x410c4
y.create.l HWIO_SPDM_OLEM_MULTIBIT_C0_OUT_ADDR A:0x41120
y.create.l HWIO_SPDM_OLEM_MULTIBIT_C1_OUT_ADDR A:0x41124
y.create.l HWIO_SPDM_OLEM_MULTIBIT_C2_OUT_ADDR A:0x41128
y.create.l HWIO_SPDM_OLEM_MULTIBIT_C3_OUT_ADDR A:0x4112c
y.create.l HWIO_SPDM_OLEM_MULTIBIT_C4_OUT_ADDR A:0x41130
y.create.l HWIO_SPDM_OLEM_MULTIBIT_C5_OUT_ADDR A:0x41134
y.create.l HWIO_SPDM_OLEM_MULTIBIT_C6_OUT_ADDR A:0x41138
y.create.l HWIO_SPDM_OLEM_MULTIBIT_C7_OUT_ADDR A:0x4113c
y.create.l HWIO_SPDM_RT_LOW_THRESH_STATUS_ADDR A:0x42000
y.create.l HWIO_SPDM_RT_HIGH_THRESH_STATUS_ADDR A:0x42004
y.create.l HWIO_SPDM_RT_LOW_IRQ_EN_0_ADDR A:0x42010
y.create.l HWIO_SPDM_RT_LOW_IRQ_EN_1_ADDR A:0x42014
y.create.l HWIO_SPDM_RT_LOW_IRQ_EN_2_ADDR A:0x42018
y.create.l HWIO_SPDM_RT_LOW_IRQ_EN_3_ADDR A:0x4201c
y.create.l HWIO_SPDM_RT_HIGH_IRQ_EN_0_ADDR A:0x42020
y.create.l HWIO_SPDM_RT_HIGH_IRQ_EN_1_ADDR A:0x42024
y.create.l HWIO_SPDM_RT_HIGH_IRQ_EN_2_ADDR A:0x42028
y.create.l HWIO_SPDM_RT_HIGH_IRQ_EN_3_ADDR A:0x4202c
y.create.l HWIO_SPDM_RT_IRQ_TIMER_0_ADDR A:0x42030
y.create.l HWIO_SPDM_RT_IRQ_TIMER_1_ADDR A:0x42034
y.create.l HWIO_SPDM_RT_IRQ_TIMER_2_ADDR A:0x42038
y.create.l HWIO_SPDM_RT_IRQ_TIMER_3_ADDR A:0x4203c
y.create.l HWIO_SPDM_RT_DIAG_MUX_SEL_ADDR A:0x42040
y.create.l HWIO_SPDM_RT_MON_EN_ADDR A:0x42050
y.create.l HWIO_SPDM_RT_MON_EN_SET_ADDR A:0x42054
y.create.l HWIO_SPDM_RT_MON_EN_CLEAR_ADDR A:0x42058
y.create.l HWIO_SPDM_RT_MON_RST_ADDR A:0x42060
y.create.l HWIO_SPDM_RT_MON_RST_SET_ADDR A:0x42064
y.create.l HWIO_SPDM_RT_MON_RST_CLEAR_ADDR A:0x42068
y.create.l HWIO_SPDM_RT_MON_CFG_0_ADDR A:0x42100
y.create.l HWIO_SPDM_RT_MON_CFG_1_ADDR A:0x42110
y.create.l HWIO_SPDM_RT_MON_CFG_2_ADDR A:0x42120
y.create.l HWIO_SPDM_RT_MON_CFG_3_ADDR A:0x42130
y.create.l HWIO_SPDM_RT_MON_CFG_4_ADDR A:0x42140
y.create.l HWIO_SPDM_RT_MON_CFG_5_ADDR A:0x42150
y.create.l HWIO_SPDM_RT_MON_CFG_6_ADDR A:0x42160
y.create.l HWIO_SPDM_RT_MON_CFG_7_ADDR A:0x42170
y.create.l HWIO_SPDM_RT_MON_CFG_8_ADDR A:0x42180
y.create.l HWIO_SPDM_RT_MON_CFG_9_ADDR A:0x42190
y.create.l HWIO_SPDM_RT_THRESH_CFG_0_ADDR A:0x42104
y.create.l HWIO_SPDM_RT_THRESH_CFG_1_ADDR A:0x42114
y.create.l HWIO_SPDM_RT_THRESH_CFG_2_ADDR A:0x42124
y.create.l HWIO_SPDM_RT_THRESH_CFG_3_ADDR A:0x42134
y.create.l HWIO_SPDM_RT_THRESH_CFG_4_ADDR A:0x42144
y.create.l HWIO_SPDM_RT_THRESH_CFG_5_ADDR A:0x42154
y.create.l HWIO_SPDM_RT_THRESH_CFG_6_ADDR A:0x42164
y.create.l HWIO_SPDM_RT_THRESH_CFG_7_ADDR A:0x42174
y.create.l HWIO_SPDM_RT_THRESH_CFG_8_ADDR A:0x42184
y.create.l HWIO_SPDM_RT_THRESH_CFG_9_ADDR A:0x42194
y.create.l HWIO_SPDM_RT_MON_STATUS_0_ADDR A:0x42108
y.create.l HWIO_SPDM_RT_MON_STATUS_1_ADDR A:0x42118
y.create.l HWIO_SPDM_RT_MON_STATUS_2_ADDR A:0x42128
y.create.l HWIO_SPDM_RT_MON_STATUS_3_ADDR A:0x42138
y.create.l HWIO_SPDM_RT_MON_STATUS_4_ADDR A:0x42148
y.create.l HWIO_SPDM_RT_MON_STATUS_5_ADDR A:0x42158
y.create.l HWIO_SPDM_RT_MON_STATUS_6_ADDR A:0x42168
y.create.l HWIO_SPDM_RT_MON_STATUS_7_ADDR A:0x42178
y.create.l HWIO_SPDM_RT_MON_STATUS_8_ADDR A:0x42188
y.create.l HWIO_SPDM_RT_MON_STATUS_9_ADDR A:0x42198
y.create.l HWIO_SPDM_SREG_CFG0_ADDR A:0x44000
y.create.l HWIO_SPDM_SREG_CFG1_ADDR A:0x44004
y.create.l HWIO_SPDM_SREG_MUTEX_0_ADDR A:0x44100
y.create.l HWIO_SNOC_OBS_ID_COREID_ADDR A:0x580000
y.create.l HWIO_SNOC_OBS_ID_REVISIONID_ADDR A:0x580004
y.create.l HWIO_SNOC_OBS_FAULTEN_ADDR A:0x580008
y.create.l HWIO_SNOC_OBS_ERRVLD_ADDR A:0x58000c
y.create.l HWIO_SNOC_OBS_ERRCLR_ADDR A:0x580010
y.create.l HWIO_SNOC_OBS_ERRLOG0_ADDR A:0x580014
y.create.l HWIO_SNOC_OBS_ERRLOG1_ADDR A:0x580018
y.create.l HWIO_SNOC_OBS_ERRLOG3_ADDR A:0x580020
y.create.l HWIO_SNOC_OBS_ERRLOG4_ADDR A:0x580024
y.create.l HWIO_SNOC_OBS_ERRLOG5_ADDR A:0x580028
y.create.l HWIO_SNOC_OBS_DBG_ID_COREID_ADDR A:0x580080
y.create.l HWIO_SNOC_OBS_DBG_ID_REVISIONID_ADDR A:0x580084
y.create.l HWIO_SNOC_OBS_DBG_ATBID_ADDR A:0x580088
y.create.l HWIO_SNOC_OBS_DBG_ATBEN_ADDR A:0x58008c
y.create.l HWIO_SNOC_OBS_DBG_SYNCPERIOD_ADDR A:0x580090
y.create.l HWIO_SNOC_MSS_TFILT_ID_COREID_ADDR A:0x581000
y.create.l HWIO_SNOC_MSS_TFILT_ID_REVISIONID_ADDR A:0x581004
y.create.l HWIO_SNOC_MSS_TFILT_MODE_ADDR A:0x581008
y.create.l HWIO_SNOC_MSS_TFILT_ADDRBASE_LOW_ADDR A:0x58100c
y.create.l HWIO_SNOC_MSS_TFILT_ADDRBASE_HIGH_ADDR A:0x581010
y.create.l HWIO_SNOC_MSS_TFILT_ADDRWINDOWSIZE_ADDR A:0x581014
y.create.l HWIO_SNOC_MSS_TFILT_SRCIDBASE_ADDR A:0x581018
y.create.l HWIO_SNOC_MSS_TFILT_SRCIDMASK_ADDR A:0x58101c
y.create.l HWIO_SNOC_MSS_TFILT_OPCODE_ADDR A:0x581020
y.create.l HWIO_SNOC_MSS_TFILT_USERBASE_ADDR A:0x581024
y.create.l HWIO_SNOC_MSS_TFILT_USERMASK_ADDR A:0x581028
y.create.l HWIO_SNOC_MSS_NAV_TFILT_ID_COREID_ADDR A:0x581080
y.create.l HWIO_SNOC_MSS_NAV_TFILT_ID_REVISIONID_ADDR A:0x581084
y.create.l HWIO_SNOC_MSS_NAV_TFILT_MODE_ADDR A:0x581088
y.create.l HWIO_SNOC_MSS_NAV_TFILT_ADDRBASE_LOW_ADDR A:0x58108c
y.create.l HWIO_SNOC_MSS_NAV_TFILT_ADDRBASE_HIGH_ADDR A:0x581090
y.create.l HWIO_SNOC_MSS_NAV_TFILT_ADDRWINDOWSIZE_ADDR A:0x581094
y.create.l HWIO_SNOC_MSS_NAV_TFILT_SRCIDBASE_ADDR A:0x581098
y.create.l HWIO_SNOC_MSS_NAV_TFILT_SRCIDMASK_ADDR A:0x58109c
y.create.l HWIO_SNOC_MSS_NAV_TFILT_OPCODE_ADDR A:0x5810a0
y.create.l HWIO_SNOC_MSS_NAV_TFILT_USERBASE_ADDR A:0x5810a4
y.create.l HWIO_SNOC_MSS_NAV_TFILT_USERMASK_ADDR A:0x5810a8
y.create.l HWIO_SNOC_VENUS0_TFILT_ID_COREID_ADDR A:0x581100
y.create.l HWIO_SNOC_VENUS0_TFILT_ID_REVISIONID_ADDR A:0x581104
y.create.l HWIO_SNOC_VENUS0_TFILT_MODE_ADDR A:0x581108
y.create.l HWIO_SNOC_VENUS0_TFILT_ADDRBASE_LOW_ADDR A:0x58110c
y.create.l HWIO_SNOC_VENUS0_TFILT_ADDRBASE_HIGH_ADDR A:0x581110
y.create.l HWIO_SNOC_VENUS0_TFILT_ADDRWINDOWSIZE_ADDR A:0x581114
y.create.l HWIO_SNOC_VENUS0_TFILT_SRCIDBASE_ADDR A:0x581118
y.create.l HWIO_SNOC_VENUS0_TFILT_SRCIDMASK_ADDR A:0x58111c
y.create.l HWIO_SNOC_VENUS0_TFILT_OPCODE_ADDR A:0x581120
y.create.l HWIO_SNOC_VENUS0_TFILT_USERBASE_ADDR A:0x581124
y.create.l HWIO_SNOC_VENUS0_TFILT_USERMASK_ADDR A:0x581128
y.create.l HWIO_SNOC_VFE_TFILT_ID_COREID_ADDR A:0x581180
y.create.l HWIO_SNOC_VFE_TFILT_ID_REVISIONID_ADDR A:0x581184
y.create.l HWIO_SNOC_VFE_TFILT_MODE_ADDR A:0x581188
y.create.l HWIO_SNOC_VFE_TFILT_ADDRBASE_LOW_ADDR A:0x58118c
y.create.l HWIO_SNOC_VFE_TFILT_ADDRBASE_HIGH_ADDR A:0x581190
y.create.l HWIO_SNOC_VFE_TFILT_ADDRWINDOWSIZE_ADDR A:0x581194
y.create.l HWIO_SNOC_VFE_TFILT_SRCIDBASE_ADDR A:0x581198
y.create.l HWIO_SNOC_VFE_TFILT_SRCIDMASK_ADDR A:0x58119c
y.create.l HWIO_SNOC_VFE_TFILT_OPCODE_ADDR A:0x5811a0
y.create.l HWIO_SNOC_VFE_TFILT_USERBASE_ADDR A:0x5811a4
y.create.l HWIO_SNOC_VFE_TFILT_USERMASK_ADDR A:0x5811a8
y.create.l HWIO_SNOC_QDSS_BAM_TFILT_ID_COREID_ADDR A:0x581200
y.create.l HWIO_SNOC_QDSS_BAM_TFILT_ID_REVISIONID_ADDR A:0x581204
y.create.l HWIO_SNOC_QDSS_BAM_TFILT_MODE_ADDR A:0x581208
y.create.l HWIO_SNOC_QDSS_BAM_TFILT_ADDRBASE_LOW_ADDR A:0x58120c
y.create.l HWIO_SNOC_QDSS_BAM_TFILT_ADDRWINDOWSIZE_ADDR A:0x581214
y.create.l HWIO_SNOC_QDSS_BAM_TFILT_SRCIDBASE_ADDR A:0x581218
y.create.l HWIO_SNOC_QDSS_BAM_TFILT_SRCIDMASK_ADDR A:0x58121c
y.create.l HWIO_SNOC_QDSS_BAM_TFILT_OPCODE_ADDR A:0x581220
y.create.l HWIO_SNOC_QDSS_BAM_TFILT_USERBASE_ADDR A:0x581224
y.create.l HWIO_SNOC_QDSS_BAM_TFILT_USERMASK_ADDR A:0x581228
y.create.l HWIO_SNOC_PCNOC_TFILT_ID_COREID_ADDR A:0x581280
y.create.l HWIO_SNOC_PCNOC_TFILT_ID_REVISIONID_ADDR A:0x581284
y.create.l HWIO_SNOC_PCNOC_TFILT_MODE_ADDR A:0x581288
y.create.l HWIO_SNOC_PCNOC_TFILT_ADDRBASE_LOW_ADDR A:0x58128c
y.create.l HWIO_SNOC_PCNOC_TFILT_ADDRBASE_HIGH_ADDR A:0x581290
y.create.l HWIO_SNOC_PCNOC_TFILT_ADDRWINDOWSIZE_ADDR A:0x581294
y.create.l HWIO_SNOC_PCNOC_TFILT_SRCIDBASE_ADDR A:0x581298
y.create.l HWIO_SNOC_PCNOC_TFILT_SRCIDMASK_ADDR A:0x58129c
y.create.l HWIO_SNOC_PCNOC_TFILT_OPCODE_ADDR A:0x5812a0
y.create.l HWIO_SNOC_PCNOC_TFILT_USERBASE_ADDR A:0x5812a4
y.create.l HWIO_SNOC_PCNOC_TFILT_USERMASK_ADDR A:0x5812a8
y.create.l HWIO_SNOC_BIMC_TFILT_ID_COREID_ADDR A:0x581300
y.create.l HWIO_SNOC_BIMC_TFILT_ID_REVISIONID_ADDR A:0x581304
y.create.l HWIO_SNOC_BIMC_TFILT_MODE_ADDR A:0x581308
y.create.l HWIO_SNOC_BIMC_TFILT_ADDRBASE_LOW_ADDR A:0x58130c
y.create.l HWIO_SNOC_BIMC_TFILT_ADDRBASE_HIGH_ADDR A:0x581310
y.create.l HWIO_SNOC_BIMC_TFILT_ADDRWINDOWSIZE_ADDR A:0x581314
y.create.l HWIO_SNOC_BIMC_TFILT_SRCIDBASE_ADDR A:0x581318
y.create.l HWIO_SNOC_BIMC_TFILT_SRCIDMASK_ADDR A:0x58131c
y.create.l HWIO_SNOC_BIMC_TFILT_OPCODE_ADDR A:0x581320
y.create.l HWIO_SNOC_BIMC_TFILT_USERBASE_ADDR A:0x581324
y.create.l HWIO_SNOC_BIMC_TFILT_USERMASK_ADDR A:0x581328
y.create.l HWIO_SNOC_WCSS_TFILT_ID_COREID_ADDR A:0x581380
y.create.l HWIO_SNOC_WCSS_TFILT_ID_REVISIONID_ADDR A:0x581384
y.create.l HWIO_SNOC_WCSS_TFILT_MODE_ADDR A:0x581388
y.create.l HWIO_SNOC_WCSS_TFILT_ADDRBASE_LOW_ADDR A:0x58138c
y.create.l HWIO_SNOC_WCSS_TFILT_ADDRBASE_HIGH_ADDR A:0x581390
y.create.l HWIO_SNOC_WCSS_TFILT_ADDRWINDOWSIZE_ADDR A:0x581394
y.create.l HWIO_SNOC_WCSS_TFILT_SRCIDBASE_ADDR A:0x581398
y.create.l HWIO_SNOC_WCSS_TFILT_SRCIDMASK_ADDR A:0x58139c
y.create.l HWIO_SNOC_WCSS_TFILT_OPCODE_ADDR A:0x5813a0
y.create.l HWIO_SNOC_WCSS_TFILT_USERBASE_ADDR A:0x5813a4
y.create.l HWIO_SNOC_WCSS_TFILT_USERMASK_ADDR A:0x5813a8
y.create.l HWIO_SNOC_QDSS_ETR_TFILT_ID_COREID_ADDR A:0x581400
y.create.l HWIO_SNOC_QDSS_ETR_TFILT_ID_REVISIONID_ADDR A:0x581404
y.create.l HWIO_SNOC_QDSS_ETR_TFILT_MODE_ADDR A:0x581408
y.create.l HWIO_SNOC_QDSS_ETR_TFILT_ADDRBASE_LOW_ADDR A:0x58140c
y.create.l HWIO_SNOC_QDSS_ETR_TFILT_ADDRWINDOWSIZE_ADDR A:0x581414
y.create.l HWIO_SNOC_QDSS_ETR_TFILT_SRCIDBASE_ADDR A:0x581418
y.create.l HWIO_SNOC_QDSS_ETR_TFILT_SRCIDMASK_ADDR A:0x58141c
y.create.l HWIO_SNOC_QDSS_ETR_TFILT_OPCODE_ADDR A:0x581420
y.create.l HWIO_SNOC_QDSS_ETR_TFILT_USERBASE_ADDR A:0x581424
y.create.l HWIO_SNOC_QDSS_ETR_TFILT_USERMASK_ADDR A:0x581428
y.create.l HWIO_SNOC_MDP0_TFILT_ID_COREID_ADDR A:0x581500
y.create.l HWIO_SNOC_MDP0_TFILT_ID_REVISIONID_ADDR A:0x581504
y.create.l HWIO_SNOC_MDP0_TFILT_MODE_ADDR A:0x581508
y.create.l HWIO_SNOC_MDP0_TFILT_ADDRBASE_LOW_ADDR A:0x58150c
y.create.l HWIO_SNOC_MDP0_TFILT_ADDRBASE_HIGH_ADDR A:0x581510
y.create.l HWIO_SNOC_MDP0_TFILT_ADDRWINDOWSIZE_ADDR A:0x581514
y.create.l HWIO_SNOC_MDP0_TFILT_SRCIDBASE_ADDR A:0x581518
y.create.l HWIO_SNOC_MDP0_TFILT_SRCIDMASK_ADDR A:0x58151c
y.create.l HWIO_SNOC_MDP0_TFILT_OPCODE_ADDR A:0x581520
y.create.l HWIO_SNOC_MDP0_TFILT_USERBASE_ADDR A:0x581524
y.create.l HWIO_SNOC_MDP0_TFILT_USERMASK_ADDR A:0x581528
y.create.l HWIO_SNOC_TPRB0_TPROF_ID_COREID_ADDR A:0x582000
y.create.l HWIO_SNOC_TPRB0_TPROF_ID_REVISIONID_ADDR A:0x582004
y.create.l HWIO_SNOC_TPRB0_TPROF_EN_ADDR A:0x582008
y.create.l HWIO_SNOC_TPRB0_TPROF_MODE_ADDR A:0x58200c
y.create.l HWIO_SNOC_TPRB0_TPROF_OBSERVEDSEL_0_ADDR A:0x582010
y.create.l HWIO_SNOC_TPRB0_TPROF_OBSERVEDSEL_1_ADDR A:0x582014
y.create.l HWIO_SNOC_TPRB0_TPROF_NTENURELINES_0_ADDR A:0x582020
y.create.l HWIO_SNOC_TPRB0_TPROF_THRESHOLDS_0_0_ADDR A:0x58202c
y.create.l HWIO_SNOC_TPRB0_TPROF_THRESHOLDS_0_1_ADDR A:0x582030
y.create.l HWIO_SNOC_TPRB0_TPROF_THRESHOLDS_0_2_ADDR A:0x582034
y.create.l HWIO_SNOC_TPRB0_TPROF_THRESHOLDS_1_0_ADDR A:0x58203c
y.create.l HWIO_SNOC_TPRB0_TPROF_THRESHOLDS_1_1_ADDR A:0x582040
y.create.l HWIO_SNOC_TPRB0_TPROF_THRESHOLDS_1_2_ADDR A:0x582044
y.create.l HWIO_SNOC_TPRB0_TPROF_OVERFLOWSTATUS_ADDR A:0x58206c
y.create.l HWIO_SNOC_TPRB0_TPROF_OVERFLOWRESET_ADDR A:0x582070
y.create.l HWIO_SNOC_TPRB0_TPROF_PENDINGEVENTMODE_ADDR A:0x582074
y.create.l HWIO_SNOC_TPRB0_TPROF_PRESCALER_ADDR A:0x582078
y.create.l HWIO_SNOC_TPRB1_TPROF_ID_COREID_ADDR A:0x582080
y.create.l HWIO_SNOC_TPRB1_TPROF_ID_REVISIONID_ADDR A:0x582084
y.create.l HWIO_SNOC_TPRB1_TPROF_EN_ADDR A:0x582088
y.create.l HWIO_SNOC_TPRB1_TPROF_MODE_ADDR A:0x58208c
y.create.l HWIO_SNOC_TPRB1_TPROF_OBSERVEDSEL_0_ADDR A:0x582090
y.create.l HWIO_SNOC_TPRB1_TPROF_OBSERVEDSEL_1_ADDR A:0x582094
y.create.l HWIO_SNOC_TPRB1_TPROF_NTENURELINES_0_ADDR A:0x5820a0
y.create.l HWIO_SNOC_TPRB1_TPROF_THRESHOLDS_0_0_ADDR A:0x5820ac
y.create.l HWIO_SNOC_TPRB1_TPROF_THRESHOLDS_0_1_ADDR A:0x5820b0
y.create.l HWIO_SNOC_TPRB1_TPROF_THRESHOLDS_0_2_ADDR A:0x5820b4
y.create.l HWIO_SNOC_TPRB1_TPROF_THRESHOLDS_1_0_ADDR A:0x5820bc
y.create.l HWIO_SNOC_TPRB1_TPROF_THRESHOLDS_1_1_ADDR A:0x5820c0
y.create.l HWIO_SNOC_TPRB1_TPROF_THRESHOLDS_1_2_ADDR A:0x5820c4
y.create.l HWIO_SNOC_TPRB1_TPROF_OVERFLOWSTATUS_ADDR A:0x5820ec
y.create.l HWIO_SNOC_TPRB1_TPROF_OVERFLOWRESET_ADDR A:0x5820f0
y.create.l HWIO_SNOC_TPRB1_TPROF_PENDINGEVENTMODE_ADDR A:0x5820f4
y.create.l HWIO_SNOC_TPRB1_TPROF_PRESCALER_ADDR A:0x5820f8
y.create.l HWIO_SNOC_TPRB2_TPROF_ID_COREID_ADDR A:0x582100
y.create.l HWIO_SNOC_TPRB2_TPROF_ID_REVISIONID_ADDR A:0x582104
y.create.l HWIO_SNOC_TPRB2_TPROF_EN_ADDR A:0x582108
y.create.l HWIO_SNOC_TPRB2_TPROF_MODE_ADDR A:0x58210c
y.create.l HWIO_SNOC_TPRB2_TPROF_OBSERVEDSEL_0_ADDR A:0x582110
y.create.l HWIO_SNOC_TPRB2_TPROF_OBSERVEDSEL_1_ADDR A:0x582114
y.create.l HWIO_SNOC_TPRB2_TPROF_NTENURELINES_0_ADDR A:0x582120
y.create.l HWIO_SNOC_TPRB2_TPROF_THRESHOLDS_0_0_ADDR A:0x58212c
y.create.l HWIO_SNOC_TPRB2_TPROF_THRESHOLDS_0_1_ADDR A:0x582130
y.create.l HWIO_SNOC_TPRB2_TPROF_THRESHOLDS_0_2_ADDR A:0x582134
y.create.l HWIO_SNOC_TPRB2_TPROF_THRESHOLDS_1_0_ADDR A:0x58213c
y.create.l HWIO_SNOC_TPRB2_TPROF_THRESHOLDS_1_1_ADDR A:0x582140
y.create.l HWIO_SNOC_TPRB2_TPROF_THRESHOLDS_1_2_ADDR A:0x582144
y.create.l HWIO_SNOC_TPRB2_TPROF_OVERFLOWSTATUS_ADDR A:0x58216c
y.create.l HWIO_SNOC_TPRB2_TPROF_OVERFLOWRESET_ADDR A:0x582170
y.create.l HWIO_SNOC_TPRB2_TPROF_PENDINGEVENTMODE_ADDR A:0x582174
y.create.l HWIO_SNOC_TPRB2_TPROF_PRESCALER_ADDR A:0x582178
y.create.l HWIO_SNOC_EPRB0_SPROF_ID_COREID_ADDR A:0x583000
y.create.l HWIO_SNOC_EPRB0_SPROF_ID_REVISIONID_ADDR A:0x583004
y.create.l HWIO_SNOC_EPRB0_SPROF_MAINCTL_ADDR A:0x583008
y.create.l HWIO_SNOC_EPRB0_SPROF_CFGCTL_ADDR A:0x58300c
y.create.l HWIO_SNOC_EPRB0_SPROF_TRACEPORTSEL_ADDR A:0x583010
y.create.l HWIO_SNOC_EPRB0_SPROF_FILTERLUT_ADDR A:0x583014
y.create.l HWIO_SNOC_EPRB0_SPROF_TRACEALARMEN_ADDR A:0x583018
y.create.l HWIO_SNOC_EPRB0_SPROF_TRACEALARMSTATUS_ADDR A:0x58301c
y.create.l HWIO_SNOC_EPRB0_SPROF_TRACEALARMCLR_ADDR A:0x583020
y.create.l HWIO_SNOC_EPRB0_SPROF_STATPERIOD_ADDR A:0x583024
y.create.l HWIO_SNOC_EPRB0_SPROF_STATGO_ADDR A:0x583028
y.create.l HWIO_SNOC_EPRB0_SPROF_STATALARMMIN_ADDR A:0x58302c
y.create.l HWIO_SNOC_EPRB0_SPROF_STATALARMMAX_ADDR A:0x583030
y.create.l HWIO_SNOC_EPRB0_SPROF_STATALARMSTATUS_ADDR A:0x583034
y.create.l HWIO_SNOC_EPRB0_SPROF_STATALARMCLR_ADDR A:0x583038
y.create.l HWIO_SNOC_EPRB0_SPROF_STATALARMEN_ADDR A:0x58303c
y.create.l HWIO_SNOC_EPRB0_SPROF_FILTERS_0_ROUTEIDBASE_ADDR A:0x583044
y.create.l HWIO_SNOC_EPRB0_SPROF_FILTERS_0_ROUTEIDMASK_ADDR A:0x583048
y.create.l HWIO_SNOC_EPRB0_SPROF_FILTERS_0_ADDRBASE_LOW_ADDR A:0x58304c
y.create.l HWIO_SNOC_EPRB0_SPROF_FILTERS_0_ADDRBASE_HIGH_ADDR A:0x583050
y.create.l HWIO_SNOC_EPRB0_SPROF_FILTERS_0_WINDOWSIZE_ADDR A:0x583054
y.create.l HWIO_SNOC_EPRB0_SPROF_FILTERS_0_OPCODE_ADDR A:0x583060
y.create.l HWIO_SNOC_EPRB0_SPROF_FILTERS_0_STATUS_ADDR A:0x583064
y.create.l HWIO_SNOC_EPRB0_SPROF_FILTERS_0_LENGTH_ADDR A:0x583068
y.create.l HWIO_SNOC_EPRB0_SPROF_FILTERS_0_URGENCY_ADDR A:0x58306c
y.create.l HWIO_SNOC_EPRB0_SPROF_FILTERS_1_ROUTEIDBASE_ADDR A:0x583080
y.create.l HWIO_SNOC_EPRB0_SPROF_FILTERS_1_ROUTEIDMASK_ADDR A:0x583084
y.create.l HWIO_SNOC_EPRB0_SPROF_FILTERS_1_ADDRBASE_LOW_ADDR A:0x583088
y.create.l HWIO_SNOC_EPRB0_SPROF_FILTERS_1_ADDRBASE_HIGH_ADDR A:0x58308c
y.create.l HWIO_SNOC_EPRB0_SPROF_FILTERS_1_WINDOWSIZE_ADDR A:0x583090
y.create.l HWIO_SNOC_EPRB0_SPROF_FILTERS_1_OPCODE_ADDR A:0x58309c
y.create.l HWIO_SNOC_EPRB0_SPROF_FILTERS_1_STATUS_ADDR A:0x5830a0
y.create.l HWIO_SNOC_EPRB0_SPROF_FILTERS_1_LENGTH_ADDR A:0x5830a4
y.create.l HWIO_SNOC_EPRB0_SPROF_FILTERS_1_URGENCY_ADDR A:0x5830a8
y.create.l HWIO_SNOC_EPRB0_SPROF_FILTERS_2_ROUTEIDBASE_ADDR A:0x5830bc
y.create.l HWIO_SNOC_EPRB0_SPROF_FILTERS_2_ROUTEIDMASK_ADDR A:0x5830c0
y.create.l HWIO_SNOC_EPRB0_SPROF_FILTERS_2_ADDRBASE_LOW_ADDR A:0x5830c4
y.create.l HWIO_SNOC_EPRB0_SPROF_FILTERS_2_ADDRBASE_HIGH_ADDR A:0x5830c8
y.create.l HWIO_SNOC_EPRB0_SPROF_FILTERS_2_WINDOWSIZE_ADDR A:0x5830cc
y.create.l HWIO_SNOC_EPRB0_SPROF_FILTERS_2_OPCODE_ADDR A:0x5830d8
y.create.l HWIO_SNOC_EPRB0_SPROF_FILTERS_2_STATUS_ADDR A:0x5830dc
y.create.l HWIO_SNOC_EPRB0_SPROF_FILTERS_2_LENGTH_ADDR A:0x5830e0
y.create.l HWIO_SNOC_EPRB0_SPROF_FILTERS_2_URGENCY_ADDR A:0x5830e4
y.create.l HWIO_SNOC_EPRB0_SPROF_FILTERS_3_ROUTEIDBASE_ADDR A:0x5830f8
y.create.l HWIO_SNOC_EPRB0_SPROF_FILTERS_3_ROUTEIDMASK_ADDR A:0x5830fc
y.create.l HWIO_SNOC_EPRB0_SPROF_FILTERS_3_ADDRBASE_LOW_ADDR A:0x583100
y.create.l HWIO_SNOC_EPRB0_SPROF_FILTERS_3_ADDRBASE_HIGH_ADDR A:0x583104
y.create.l HWIO_SNOC_EPRB0_SPROF_FILTERS_3_WINDOWSIZE_ADDR A:0x583108
y.create.l HWIO_SNOC_EPRB0_SPROF_FILTERS_3_OPCODE_ADDR A:0x583114
y.create.l HWIO_SNOC_EPRB0_SPROF_FILTERS_3_STATUS_ADDR A:0x583118
y.create.l HWIO_SNOC_EPRB0_SPROF_FILTERS_3_LENGTH_ADDR A:0x58311c
y.create.l HWIO_SNOC_EPRB0_SPROF_FILTERS_3_URGENCY_ADDR A:0x583120
y.create.l HWIO_SNOC_EPRB0_SPROF_COUNTERS_0_PORTSEL_ADDR A:0x583134
y.create.l HWIO_SNOC_EPRB0_SPROF_COUNTERS_0_SRC_ADDR A:0x583138
y.create.l HWIO_SNOC_EPRB0_SPROF_COUNTERS_0_ALARMMODE_ADDR A:0x58313c
y.create.l HWIO_SNOC_EPRB0_SPROF_COUNTERS_0_VAL_ADDR A:0x583140
y.create.l HWIO_SNOC_EPRB0_SPROF_COUNTERS_1_PORTSEL_ADDR A:0x583148
y.create.l HWIO_SNOC_EPRB0_SPROF_COUNTERS_1_SRC_ADDR A:0x58314c
y.create.l HWIO_SNOC_EPRB0_SPROF_COUNTERS_1_ALARMMODE_ADDR A:0x583150
y.create.l HWIO_SNOC_EPRB0_SPROF_COUNTERS_1_VAL_ADDR A:0x583154
y.create.l HWIO_SNOC_EPRB0_SPROF_COUNTERS_2_PORTSEL_ADDR A:0x58315c
y.create.l HWIO_SNOC_EPRB0_SPROF_COUNTERS_2_SRC_ADDR A:0x583160
y.create.l HWIO_SNOC_EPRB0_SPROF_COUNTERS_2_ALARMMODE_ADDR A:0x583164
y.create.l HWIO_SNOC_EPRB0_SPROF_COUNTERS_2_VAL_ADDR A:0x583168
y.create.l HWIO_SNOC_EPRB0_SPROF_COUNTERS_3_PORTSEL_ADDR A:0x583170
y.create.l HWIO_SNOC_EPRB0_SPROF_COUNTERS_3_SRC_ADDR A:0x583174
y.create.l HWIO_SNOC_EPRB0_SPROF_COUNTERS_3_ALARMMODE_ADDR A:0x583178
y.create.l HWIO_SNOC_EPRB0_SPROF_COUNTERS_3_VAL_ADDR A:0x58317c
y.create.l HWIO_SNOC_EPRB0_SPROF_COUNTERS_4_PORTSEL_ADDR A:0x583184
y.create.l HWIO_SNOC_EPRB0_SPROF_COUNTERS_4_SRC_ADDR A:0x583188
y.create.l HWIO_SNOC_EPRB0_SPROF_COUNTERS_4_ALARMMODE_ADDR A:0x58318c
y.create.l HWIO_SNOC_EPRB0_SPROF_COUNTERS_4_VAL_ADDR A:0x583190
y.create.l HWIO_SNOC_EPRB0_SPROF_COUNTERS_5_PORTSEL_ADDR A:0x583198
y.create.l HWIO_SNOC_EPRB0_SPROF_COUNTERS_5_SRC_ADDR A:0x58319c
y.create.l HWIO_SNOC_EPRB0_SPROF_COUNTERS_5_ALARMMODE_ADDR A:0x5831a0
y.create.l HWIO_SNOC_EPRB0_SPROF_COUNTERS_5_VAL_ADDR A:0x5831a4
y.create.l HWIO_SNOC_EPRB0_SPROF_COUNTERS_6_PORTSEL_ADDR A:0x5831ac
y.create.l HWIO_SNOC_EPRB0_SPROF_COUNTERS_6_SRC_ADDR A:0x5831b0
y.create.l HWIO_SNOC_EPRB0_SPROF_COUNTERS_6_ALARMMODE_ADDR A:0x5831b4
y.create.l HWIO_SNOC_EPRB0_SPROF_COUNTERS_6_VAL_ADDR A:0x5831b8
y.create.l HWIO_SNOC_EPRB0_SPROF_COUNTERS_7_PORTSEL_ADDR A:0x5831c0
y.create.l HWIO_SNOC_EPRB0_SPROF_COUNTERS_7_SRC_ADDR A:0x5831c4
y.create.l HWIO_SNOC_EPRB0_SPROF_COUNTERS_7_ALARMMODE_ADDR A:0x5831c8
y.create.l HWIO_SNOC_EPRB0_SPROF_COUNTERS_7_VAL_ADDR A:0x5831cc
y.create.l HWIO_SNOC_EPRB0_SPROF_COUNTERS_8_PORTSEL_ADDR A:0x5831d4
y.create.l HWIO_SNOC_EPRB0_SPROF_COUNTERS_8_SRC_ADDR A:0x5831d8
y.create.l HWIO_SNOC_EPRB0_SPROF_COUNTERS_8_ALARMMODE_ADDR A:0x5831dc
y.create.l HWIO_SNOC_EPRB0_SPROF_COUNTERS_8_VAL_ADDR A:0x5831e0
y.create.l HWIO_SNOC_EPRB0_SPROF_COUNTERS_9_PORTSEL_ADDR A:0x5831e8
y.create.l HWIO_SNOC_EPRB0_SPROF_COUNTERS_9_SRC_ADDR A:0x5831ec
y.create.l HWIO_SNOC_EPRB0_SPROF_COUNTERS_9_ALARMMODE_ADDR A:0x5831f0
y.create.l HWIO_SNOC_EPRB0_SPROF_COUNTERS_9_VAL_ADDR A:0x5831f4
y.create.l HWIO_SNOC_EPRB1_SPROF_ID_COREID_ADDR A:0x583400
y.create.l HWIO_SNOC_EPRB1_SPROF_ID_REVISIONID_ADDR A:0x583404
y.create.l HWIO_SNOC_EPRB1_SPROF_MAINCTL_ADDR A:0x583408
y.create.l HWIO_SNOC_EPRB1_SPROF_CFGCTL_ADDR A:0x58340c
y.create.l HWIO_SNOC_EPRB1_SPROF_TRACEPORTSEL_ADDR A:0x583410
y.create.l HWIO_SNOC_EPRB1_SPROF_FILTERLUT_ADDR A:0x583414
y.create.l HWIO_SNOC_EPRB1_SPROF_TRACEALARMEN_ADDR A:0x583418
y.create.l HWIO_SNOC_EPRB1_SPROF_TRACEALARMSTATUS_ADDR A:0x58341c
y.create.l HWIO_SNOC_EPRB1_SPROF_TRACEALARMCLR_ADDR A:0x583420
y.create.l HWIO_SNOC_EPRB1_SPROF_STATPERIOD_ADDR A:0x583424
y.create.l HWIO_SNOC_EPRB1_SPROF_STATGO_ADDR A:0x583428
y.create.l HWIO_SNOC_EPRB1_SPROF_STATALARMMIN_ADDR A:0x58342c
y.create.l HWIO_SNOC_EPRB1_SPROF_STATALARMMAX_ADDR A:0x583430
y.create.l HWIO_SNOC_EPRB1_SPROF_STATALARMSTATUS_ADDR A:0x583434
y.create.l HWIO_SNOC_EPRB1_SPROF_STATALARMCLR_ADDR A:0x583438
y.create.l HWIO_SNOC_EPRB1_SPROF_STATALARMEN_ADDR A:0x58343c
y.create.l HWIO_SNOC_EPRB1_SPROF_FILTERS_0_ROUTEIDBASE_ADDR A:0x583444
y.create.l HWIO_SNOC_EPRB1_SPROF_FILTERS_0_ROUTEIDMASK_ADDR A:0x583448
y.create.l HWIO_SNOC_EPRB1_SPROF_FILTERS_0_ADDRBASE_LOW_ADDR A:0x58344c
y.create.l HWIO_SNOC_EPRB1_SPROF_FILTERS_0_ADDRBASE_HIGH_ADDR A:0x583450
y.create.l HWIO_SNOC_EPRB1_SPROF_FILTERS_0_WINDOWSIZE_ADDR A:0x583454
y.create.l HWIO_SNOC_EPRB1_SPROF_FILTERS_0_OPCODE_ADDR A:0x583460
y.create.l HWIO_SNOC_EPRB1_SPROF_FILTERS_0_STATUS_ADDR A:0x583464
y.create.l HWIO_SNOC_EPRB1_SPROF_FILTERS_0_LENGTH_ADDR A:0x583468
y.create.l HWIO_SNOC_EPRB1_SPROF_FILTERS_0_URGENCY_ADDR A:0x58346c
y.create.l HWIO_SNOC_EPRB1_SPROF_FILTERS_1_ROUTEIDBASE_ADDR A:0x583480
y.create.l HWIO_SNOC_EPRB1_SPROF_FILTERS_1_ROUTEIDMASK_ADDR A:0x583484
y.create.l HWIO_SNOC_EPRB1_SPROF_FILTERS_1_ADDRBASE_LOW_ADDR A:0x583488
y.create.l HWIO_SNOC_EPRB1_SPROF_FILTERS_1_ADDRBASE_HIGH_ADDR A:0x58348c
y.create.l HWIO_SNOC_EPRB1_SPROF_FILTERS_1_WINDOWSIZE_ADDR A:0x583490
y.create.l HWIO_SNOC_EPRB1_SPROF_FILTERS_1_OPCODE_ADDR A:0x58349c
y.create.l HWIO_SNOC_EPRB1_SPROF_FILTERS_1_STATUS_ADDR A:0x5834a0
y.create.l HWIO_SNOC_EPRB1_SPROF_FILTERS_1_LENGTH_ADDR A:0x5834a4
y.create.l HWIO_SNOC_EPRB1_SPROF_FILTERS_1_URGENCY_ADDR A:0x5834a8
y.create.l HWIO_SNOC_EPRB1_SPROF_FILTERS_2_ROUTEIDBASE_ADDR A:0x5834bc
y.create.l HWIO_SNOC_EPRB1_SPROF_FILTERS_2_ROUTEIDMASK_ADDR A:0x5834c0
y.create.l HWIO_SNOC_EPRB1_SPROF_FILTERS_2_ADDRBASE_LOW_ADDR A:0x5834c4
y.create.l HWIO_SNOC_EPRB1_SPROF_FILTERS_2_ADDRBASE_HIGH_ADDR A:0x5834c8
y.create.l HWIO_SNOC_EPRB1_SPROF_FILTERS_2_WINDOWSIZE_ADDR A:0x5834cc
y.create.l HWIO_SNOC_EPRB1_SPROF_FILTERS_2_OPCODE_ADDR A:0x5834d8
y.create.l HWIO_SNOC_EPRB1_SPROF_FILTERS_2_STATUS_ADDR A:0x5834dc
y.create.l HWIO_SNOC_EPRB1_SPROF_FILTERS_2_LENGTH_ADDR A:0x5834e0
y.create.l HWIO_SNOC_EPRB1_SPROF_FILTERS_2_URGENCY_ADDR A:0x5834e4
y.create.l HWIO_SNOC_EPRB1_SPROF_FILTERS_3_ROUTEIDBASE_ADDR A:0x5834f8
y.create.l HWIO_SNOC_EPRB1_SPROF_FILTERS_3_ROUTEIDMASK_ADDR A:0x5834fc
y.create.l HWIO_SNOC_EPRB1_SPROF_FILTERS_3_ADDRBASE_LOW_ADDR A:0x583500
y.create.l HWIO_SNOC_EPRB1_SPROF_FILTERS_3_ADDRBASE_HIGH_ADDR A:0x583504
y.create.l HWIO_SNOC_EPRB1_SPROF_FILTERS_3_WINDOWSIZE_ADDR A:0x583508
y.create.l HWIO_SNOC_EPRB1_SPROF_FILTERS_3_OPCODE_ADDR A:0x583514
y.create.l HWIO_SNOC_EPRB1_SPROF_FILTERS_3_STATUS_ADDR A:0x583518
y.create.l HWIO_SNOC_EPRB1_SPROF_FILTERS_3_LENGTH_ADDR A:0x58351c
y.create.l HWIO_SNOC_EPRB1_SPROF_FILTERS_3_URGENCY_ADDR A:0x583520
y.create.l HWIO_SNOC_EPRB1_SPROF_COUNTERS_0_PORTSEL_ADDR A:0x583534
y.create.l HWIO_SNOC_EPRB1_SPROF_COUNTERS_0_SRC_ADDR A:0x583538
y.create.l HWIO_SNOC_EPRB1_SPROF_COUNTERS_0_ALARMMODE_ADDR A:0x58353c
y.create.l HWIO_SNOC_EPRB1_SPROF_COUNTERS_0_VAL_ADDR A:0x583540
y.create.l HWIO_SNOC_EPRB1_SPROF_COUNTERS_1_PORTSEL_ADDR A:0x583548
y.create.l HWIO_SNOC_EPRB1_SPROF_COUNTERS_1_SRC_ADDR A:0x58354c
y.create.l HWIO_SNOC_EPRB1_SPROF_COUNTERS_1_ALARMMODE_ADDR A:0x583550
y.create.l HWIO_SNOC_EPRB1_SPROF_COUNTERS_1_VAL_ADDR A:0x583554
y.create.l HWIO_SNOC_EPRB1_SPROF_COUNTERS_2_PORTSEL_ADDR A:0x58355c
y.create.l HWIO_SNOC_EPRB1_SPROF_COUNTERS_2_SRC_ADDR A:0x583560
y.create.l HWIO_SNOC_EPRB1_SPROF_COUNTERS_2_ALARMMODE_ADDR A:0x583564
y.create.l HWIO_SNOC_EPRB1_SPROF_COUNTERS_2_VAL_ADDR A:0x583568
y.create.l HWIO_SNOC_EPRB1_SPROF_COUNTERS_3_PORTSEL_ADDR A:0x583570
y.create.l HWIO_SNOC_EPRB1_SPROF_COUNTERS_3_SRC_ADDR A:0x583574
y.create.l HWIO_SNOC_EPRB1_SPROF_COUNTERS_3_ALARMMODE_ADDR A:0x583578
y.create.l HWIO_SNOC_EPRB1_SPROF_COUNTERS_3_VAL_ADDR A:0x58357c
y.create.l HWIO_SNOC_EPRB1_SPROF_COUNTERS_4_PORTSEL_ADDR A:0x583584
y.create.l HWIO_SNOC_EPRB1_SPROF_COUNTERS_4_SRC_ADDR A:0x583588
y.create.l HWIO_SNOC_EPRB1_SPROF_COUNTERS_4_ALARMMODE_ADDR A:0x58358c
y.create.l HWIO_SNOC_EPRB1_SPROF_COUNTERS_4_VAL_ADDR A:0x583590
y.create.l HWIO_SNOC_EPRB1_SPROF_COUNTERS_5_PORTSEL_ADDR A:0x583598
y.create.l HWIO_SNOC_EPRB1_SPROF_COUNTERS_5_SRC_ADDR A:0x58359c
y.create.l HWIO_SNOC_EPRB1_SPROF_COUNTERS_5_ALARMMODE_ADDR A:0x5835a0
y.create.l HWIO_SNOC_EPRB1_SPROF_COUNTERS_5_VAL_ADDR A:0x5835a4
y.create.l HWIO_SNOC_EPRB1_SPROF_COUNTERS_6_PORTSEL_ADDR A:0x5835ac
y.create.l HWIO_SNOC_EPRB1_SPROF_COUNTERS_6_SRC_ADDR A:0x5835b0
y.create.l HWIO_SNOC_EPRB1_SPROF_COUNTERS_6_ALARMMODE_ADDR A:0x5835b4
y.create.l HWIO_SNOC_EPRB1_SPROF_COUNTERS_6_VAL_ADDR A:0x5835b8
y.create.l HWIO_SNOC_EPRB1_SPROF_COUNTERS_7_PORTSEL_ADDR A:0x5835c0
y.create.l HWIO_SNOC_EPRB1_SPROF_COUNTERS_7_SRC_ADDR A:0x5835c4
y.create.l HWIO_SNOC_EPRB1_SPROF_COUNTERS_7_ALARMMODE_ADDR A:0x5835c8
y.create.l HWIO_SNOC_EPRB1_SPROF_COUNTERS_7_VAL_ADDR A:0x5835cc
y.create.l HWIO_SNOC_EPRB1_SPROF_COUNTERS_8_PORTSEL_ADDR A:0x5835d4
y.create.l HWIO_SNOC_EPRB1_SPROF_COUNTERS_8_SRC_ADDR A:0x5835d8
y.create.l HWIO_SNOC_EPRB1_SPROF_COUNTERS_8_ALARMMODE_ADDR A:0x5835dc
y.create.l HWIO_SNOC_EPRB1_SPROF_COUNTERS_8_VAL_ADDR A:0x5835e0
y.create.l HWIO_SNOC_EPRB1_SPROF_COUNTERS_9_PORTSEL_ADDR A:0x5835e8
y.create.l HWIO_SNOC_EPRB1_SPROF_COUNTERS_9_SRC_ADDR A:0x5835ec
y.create.l HWIO_SNOC_EPRB1_SPROF_COUNTERS_9_ALARMMODE_ADDR A:0x5835f0
y.create.l HWIO_SNOC_EPRB1_SPROF_COUNTERS_9_VAL_ADDR A:0x5835f4
y.create.l HWIO_SNOC_TPRB0_SPROF_ID_COREID_ADDR A:0x584000
y.create.l HWIO_SNOC_TPRB0_SPROF_ID_REVISIONID_ADDR A:0x584004
y.create.l HWIO_SNOC_TPRB0_SPROF_MAINCTL_ADDR A:0x584008
y.create.l HWIO_SNOC_TPRB0_SPROF_CFGCTL_ADDR A:0x58400c
y.create.l HWIO_SNOC_TPRB0_SPROF_STATPERIOD_ADDR A:0x584024
y.create.l HWIO_SNOC_TPRB0_SPROF_STATGO_ADDR A:0x584028
y.create.l HWIO_SNOC_TPRB0_SPROF_STATALARMMIN_ADDR A:0x58402c
y.create.l HWIO_SNOC_TPRB0_SPROF_STATALARMMAX_ADDR A:0x584030
y.create.l HWIO_SNOC_TPRB0_SPROF_STATALARMSTATUS_ADDR A:0x584034
y.create.l HWIO_SNOC_TPRB0_SPROF_STATALARMCLR_ADDR A:0x584038
y.create.l HWIO_SNOC_TPRB0_SPROF_STATALARMEN_ADDR A:0x58403c
y.create.l HWIO_SNOC_TPRB0_SPROF_COUNTERS_0_SRC_ADDR A:0x584138
y.create.l HWIO_SNOC_TPRB0_SPROF_COUNTERS_0_ALARMMODE_ADDR A:0x58413c
y.create.l HWIO_SNOC_TPRB0_SPROF_COUNTERS_0_VAL_ADDR A:0x584140
y.create.l HWIO_SNOC_TPRB0_SPROF_COUNTERS_1_SRC_ADDR A:0x58414c
y.create.l HWIO_SNOC_TPRB0_SPROF_COUNTERS_1_ALARMMODE_ADDR A:0x584150
y.create.l HWIO_SNOC_TPRB0_SPROF_COUNTERS_1_VAL_ADDR A:0x584154
y.create.l HWIO_SNOC_TPRB0_SPROF_COUNTERS_2_SRC_ADDR A:0x584160
y.create.l HWIO_SNOC_TPRB0_SPROF_COUNTERS_2_ALARMMODE_ADDR A:0x584164
y.create.l HWIO_SNOC_TPRB0_SPROF_COUNTERS_2_VAL_ADDR A:0x584168
y.create.l HWIO_SNOC_TPRB0_SPROF_COUNTERS_3_SRC_ADDR A:0x584174
y.create.l HWIO_SNOC_TPRB0_SPROF_COUNTERS_3_ALARMMODE_ADDR A:0x584178
y.create.l HWIO_SNOC_TPRB0_SPROF_COUNTERS_3_VAL_ADDR A:0x58417c
y.create.l HWIO_SNOC_TPRB0_SPROF_COUNTERS_4_SRC_ADDR A:0x584188
y.create.l HWIO_SNOC_TPRB0_SPROF_COUNTERS_4_ALARMMODE_ADDR A:0x58418c
y.create.l HWIO_SNOC_TPRB0_SPROF_COUNTERS_4_VAL_ADDR A:0x584190
y.create.l HWIO_SNOC_TPRB0_SPROF_COUNTERS_5_SRC_ADDR A:0x58419c
y.create.l HWIO_SNOC_TPRB0_SPROF_COUNTERS_5_ALARMMODE_ADDR A:0x5841a0
y.create.l HWIO_SNOC_TPRB0_SPROF_COUNTERS_5_VAL_ADDR A:0x5841a4
y.create.l HWIO_SNOC_TPRB0_SPROF_COUNTERS_6_SRC_ADDR A:0x5841b0
y.create.l HWIO_SNOC_TPRB0_SPROF_COUNTERS_6_ALARMMODE_ADDR A:0x5841b4
y.create.l HWIO_SNOC_TPRB0_SPROF_COUNTERS_6_VAL_ADDR A:0x5841b8
y.create.l HWIO_SNOC_TPRB0_SPROF_COUNTERS_7_SRC_ADDR A:0x5841c4
y.create.l HWIO_SNOC_TPRB0_SPROF_COUNTERS_7_ALARMMODE_ADDR A:0x5841c8
y.create.l HWIO_SNOC_TPRB0_SPROF_COUNTERS_7_VAL_ADDR A:0x5841cc
y.create.l HWIO_SNOC_TPRB0_SPROF_COUNTERS_8_SRC_ADDR A:0x5841d8
y.create.l HWIO_SNOC_TPRB0_SPROF_COUNTERS_8_ALARMMODE_ADDR A:0x5841dc
y.create.l HWIO_SNOC_TPRB0_SPROF_COUNTERS_8_VAL_ADDR A:0x5841e0
y.create.l HWIO_SNOC_TPRB0_SPROF_COUNTERS_9_SRC_ADDR A:0x5841ec
y.create.l HWIO_SNOC_TPRB0_SPROF_COUNTERS_9_ALARMMODE_ADDR A:0x5841f0
y.create.l HWIO_SNOC_TPRB0_SPROF_COUNTERS_9_VAL_ADDR A:0x5841f4
y.create.l HWIO_SNOC_TPRB0_SPROF_COUNTERS_10_SRC_ADDR A:0x584200
y.create.l HWIO_SNOC_TPRB0_SPROF_COUNTERS_10_ALARMMODE_ADDR A:0x584204
y.create.l HWIO_SNOC_TPRB0_SPROF_COUNTERS_10_VAL_ADDR A:0x584208
y.create.l HWIO_SNOC_TPRB0_SPROF_COUNTERS_11_SRC_ADDR A:0x584214
y.create.l HWIO_SNOC_TPRB0_SPROF_COUNTERS_11_ALARMMODE_ADDR A:0x584218
y.create.l HWIO_SNOC_TPRB0_SPROF_COUNTERS_11_VAL_ADDR A:0x58421c
y.create.l HWIO_SNOC_TPRB0_SPROF_COUNTERS_12_SRC_ADDR A:0x584228
y.create.l HWIO_SNOC_TPRB0_SPROF_COUNTERS_12_ALARMMODE_ADDR A:0x58422c
y.create.l HWIO_SNOC_TPRB0_SPROF_COUNTERS_12_VAL_ADDR A:0x584230
y.create.l HWIO_SNOC_TPRB0_SPROF_COUNTERS_13_SRC_ADDR A:0x58423c
y.create.l HWIO_SNOC_TPRB0_SPROF_COUNTERS_13_ALARMMODE_ADDR A:0x584240
y.create.l HWIO_SNOC_TPRB0_SPROF_COUNTERS_13_VAL_ADDR A:0x584244
y.create.l HWIO_SNOC_TPRB0_SPROF_COUNTERS_14_SRC_ADDR A:0x584250
y.create.l HWIO_SNOC_TPRB0_SPROF_COUNTERS_14_ALARMMODE_ADDR A:0x584254
y.create.l HWIO_SNOC_TPRB0_SPROF_COUNTERS_14_VAL_ADDR A:0x584258
y.create.l HWIO_SNOC_TPRB0_SPROF_COUNTERS_15_SRC_ADDR A:0x584264
y.create.l HWIO_SNOC_TPRB0_SPROF_COUNTERS_15_ALARMMODE_ADDR A:0x584268
y.create.l HWIO_SNOC_TPRB0_SPROF_COUNTERS_15_VAL_ADDR A:0x58426c
y.create.l HWIO_SNOC_TPRB1_SPROF_ID_COREID_ADDR A:0x584400
y.create.l HWIO_SNOC_TPRB1_SPROF_ID_REVISIONID_ADDR A:0x584404
y.create.l HWIO_SNOC_TPRB1_SPROF_MAINCTL_ADDR A:0x584408
y.create.l HWIO_SNOC_TPRB1_SPROF_CFGCTL_ADDR A:0x58440c
y.create.l HWIO_SNOC_TPRB1_SPROF_STATPERIOD_ADDR A:0x584424
y.create.l HWIO_SNOC_TPRB1_SPROF_STATGO_ADDR A:0x584428
y.create.l HWIO_SNOC_TPRB1_SPROF_STATALARMMIN_ADDR A:0x58442c
y.create.l HWIO_SNOC_TPRB1_SPROF_STATALARMMAX_ADDR A:0x584430
y.create.l HWIO_SNOC_TPRB1_SPROF_STATALARMSTATUS_ADDR A:0x584434
y.create.l HWIO_SNOC_TPRB1_SPROF_STATALARMCLR_ADDR A:0x584438
y.create.l HWIO_SNOC_TPRB1_SPROF_STATALARMEN_ADDR A:0x58443c
y.create.l HWIO_SNOC_TPRB1_SPROF_COUNTERS_0_SRC_ADDR A:0x584538
y.create.l HWIO_SNOC_TPRB1_SPROF_COUNTERS_0_ALARMMODE_ADDR A:0x58453c
y.create.l HWIO_SNOC_TPRB1_SPROF_COUNTERS_0_VAL_ADDR A:0x584540
y.create.l HWIO_SNOC_TPRB1_SPROF_COUNTERS_1_SRC_ADDR A:0x58454c
y.create.l HWIO_SNOC_TPRB1_SPROF_COUNTERS_1_ALARMMODE_ADDR A:0x584550
y.create.l HWIO_SNOC_TPRB1_SPROF_COUNTERS_1_VAL_ADDR A:0x584554
y.create.l HWIO_SNOC_TPRB1_SPROF_COUNTERS_2_SRC_ADDR A:0x584560
y.create.l HWIO_SNOC_TPRB1_SPROF_COUNTERS_2_ALARMMODE_ADDR A:0x584564
y.create.l HWIO_SNOC_TPRB1_SPROF_COUNTERS_2_VAL_ADDR A:0x584568
y.create.l HWIO_SNOC_TPRB1_SPROF_COUNTERS_3_SRC_ADDR A:0x584574
y.create.l HWIO_SNOC_TPRB1_SPROF_COUNTERS_3_ALARMMODE_ADDR A:0x584578
y.create.l HWIO_SNOC_TPRB1_SPROF_COUNTERS_3_VAL_ADDR A:0x58457c
y.create.l HWIO_SNOC_TPRB1_SPROF_COUNTERS_4_SRC_ADDR A:0x584588
y.create.l HWIO_SNOC_TPRB1_SPROF_COUNTERS_4_ALARMMODE_ADDR A:0x58458c
y.create.l HWIO_SNOC_TPRB1_SPROF_COUNTERS_4_VAL_ADDR A:0x584590
y.create.l HWIO_SNOC_TPRB1_SPROF_COUNTERS_5_SRC_ADDR A:0x58459c
y.create.l HWIO_SNOC_TPRB1_SPROF_COUNTERS_5_ALARMMODE_ADDR A:0x5845a0
y.create.l HWIO_SNOC_TPRB1_SPROF_COUNTERS_5_VAL_ADDR A:0x5845a4
y.create.l HWIO_SNOC_TPRB1_SPROF_COUNTERS_6_SRC_ADDR A:0x5845b0
y.create.l HWIO_SNOC_TPRB1_SPROF_COUNTERS_6_ALARMMODE_ADDR A:0x5845b4
y.create.l HWIO_SNOC_TPRB1_SPROF_COUNTERS_6_VAL_ADDR A:0x5845b8
y.create.l HWIO_SNOC_TPRB1_SPROF_COUNTERS_7_SRC_ADDR A:0x5845c4
y.create.l HWIO_SNOC_TPRB1_SPROF_COUNTERS_7_ALARMMODE_ADDR A:0x5845c8
y.create.l HWIO_SNOC_TPRB1_SPROF_COUNTERS_7_VAL_ADDR A:0x5845cc
y.create.l HWIO_SNOC_TPRB1_SPROF_COUNTERS_8_SRC_ADDR A:0x5845d8
y.create.l HWIO_SNOC_TPRB1_SPROF_COUNTERS_8_ALARMMODE_ADDR A:0x5845dc
y.create.l HWIO_SNOC_TPRB1_SPROF_COUNTERS_8_VAL_ADDR A:0x5845e0
y.create.l HWIO_SNOC_TPRB1_SPROF_COUNTERS_9_SRC_ADDR A:0x5845ec
y.create.l HWIO_SNOC_TPRB1_SPROF_COUNTERS_9_ALARMMODE_ADDR A:0x5845f0
y.create.l HWIO_SNOC_TPRB1_SPROF_COUNTERS_9_VAL_ADDR A:0x5845f4
y.create.l HWIO_SNOC_TPRB1_SPROF_COUNTERS_10_SRC_ADDR A:0x584600
y.create.l HWIO_SNOC_TPRB1_SPROF_COUNTERS_10_ALARMMODE_ADDR A:0x584604
y.create.l HWIO_SNOC_TPRB1_SPROF_COUNTERS_10_VAL_ADDR A:0x584608
y.create.l HWIO_SNOC_TPRB1_SPROF_COUNTERS_11_SRC_ADDR A:0x584614
y.create.l HWIO_SNOC_TPRB1_SPROF_COUNTERS_11_ALARMMODE_ADDR A:0x584618
y.create.l HWIO_SNOC_TPRB1_SPROF_COUNTERS_11_VAL_ADDR A:0x58461c
y.create.l HWIO_SNOC_TPRB1_SPROF_COUNTERS_12_SRC_ADDR A:0x584628
y.create.l HWIO_SNOC_TPRB1_SPROF_COUNTERS_12_ALARMMODE_ADDR A:0x58462c
y.create.l HWIO_SNOC_TPRB1_SPROF_COUNTERS_12_VAL_ADDR A:0x584630
y.create.l HWIO_SNOC_TPRB1_SPROF_COUNTERS_13_SRC_ADDR A:0x58463c
y.create.l HWIO_SNOC_TPRB1_SPROF_COUNTERS_13_ALARMMODE_ADDR A:0x584640
y.create.l HWIO_SNOC_TPRB1_SPROF_COUNTERS_13_VAL_ADDR A:0x584644
y.create.l HWIO_SNOC_TPRB1_SPROF_COUNTERS_14_SRC_ADDR A:0x584650
y.create.l HWIO_SNOC_TPRB1_SPROF_COUNTERS_14_ALARMMODE_ADDR A:0x584654
y.create.l HWIO_SNOC_TPRB1_SPROF_COUNTERS_14_VAL_ADDR A:0x584658
y.create.l HWIO_SNOC_TPRB1_SPROF_COUNTERS_15_SRC_ADDR A:0x584664
y.create.l HWIO_SNOC_TPRB1_SPROF_COUNTERS_15_ALARMMODE_ADDR A:0x584668
y.create.l HWIO_SNOC_TPRB1_SPROF_COUNTERS_15_VAL_ADDR A:0x58466c
y.create.l HWIO_SNOC_TPRB2_SPROF_ID_COREID_ADDR A:0x584800
y.create.l HWIO_SNOC_TPRB2_SPROF_ID_REVISIONID_ADDR A:0x584804
y.create.l HWIO_SNOC_TPRB2_SPROF_MAINCTL_ADDR A:0x584808
y.create.l HWIO_SNOC_TPRB2_SPROF_CFGCTL_ADDR A:0x58480c
y.create.l HWIO_SNOC_TPRB2_SPROF_STATPERIOD_ADDR A:0x584824
y.create.l HWIO_SNOC_TPRB2_SPROF_STATGO_ADDR A:0x584828
y.create.l HWIO_SNOC_TPRB2_SPROF_STATALARMMIN_ADDR A:0x58482c
y.create.l HWIO_SNOC_TPRB2_SPROF_STATALARMMAX_ADDR A:0x584830
y.create.l HWIO_SNOC_TPRB2_SPROF_STATALARMSTATUS_ADDR A:0x584834
y.create.l HWIO_SNOC_TPRB2_SPROF_STATALARMCLR_ADDR A:0x584838
y.create.l HWIO_SNOC_TPRB2_SPROF_STATALARMEN_ADDR A:0x58483c
y.create.l HWIO_SNOC_TPRB2_SPROF_COUNTERS_0_SRC_ADDR A:0x584938
y.create.l HWIO_SNOC_TPRB2_SPROF_COUNTERS_0_ALARMMODE_ADDR A:0x58493c
y.create.l HWIO_SNOC_TPRB2_SPROF_COUNTERS_0_VAL_ADDR A:0x584940
y.create.l HWIO_SNOC_TPRB2_SPROF_COUNTERS_1_SRC_ADDR A:0x58494c
y.create.l HWIO_SNOC_TPRB2_SPROF_COUNTERS_1_ALARMMODE_ADDR A:0x584950
y.create.l HWIO_SNOC_TPRB2_SPROF_COUNTERS_1_VAL_ADDR A:0x584954
y.create.l HWIO_SNOC_TPRB2_SPROF_COUNTERS_2_SRC_ADDR A:0x584960
y.create.l HWIO_SNOC_TPRB2_SPROF_COUNTERS_2_ALARMMODE_ADDR A:0x584964
y.create.l HWIO_SNOC_TPRB2_SPROF_COUNTERS_2_VAL_ADDR A:0x584968
y.create.l HWIO_SNOC_TPRB2_SPROF_COUNTERS_3_SRC_ADDR A:0x584974
y.create.l HWIO_SNOC_TPRB2_SPROF_COUNTERS_3_ALARMMODE_ADDR A:0x584978
y.create.l HWIO_SNOC_TPRB2_SPROF_COUNTERS_3_VAL_ADDR A:0x58497c
y.create.l HWIO_SNOC_TPRB2_SPROF_COUNTERS_4_SRC_ADDR A:0x584988
y.create.l HWIO_SNOC_TPRB2_SPROF_COUNTERS_4_ALARMMODE_ADDR A:0x58498c
y.create.l HWIO_SNOC_TPRB2_SPROF_COUNTERS_4_VAL_ADDR A:0x584990
y.create.l HWIO_SNOC_TPRB2_SPROF_COUNTERS_5_SRC_ADDR A:0x58499c
y.create.l HWIO_SNOC_TPRB2_SPROF_COUNTERS_5_ALARMMODE_ADDR A:0x5849a0
y.create.l HWIO_SNOC_TPRB2_SPROF_COUNTERS_5_VAL_ADDR A:0x5849a4
y.create.l HWIO_SNOC_TPRB2_SPROF_COUNTERS_6_SRC_ADDR A:0x5849b0
y.create.l HWIO_SNOC_TPRB2_SPROF_COUNTERS_6_ALARMMODE_ADDR A:0x5849b4
y.create.l HWIO_SNOC_TPRB2_SPROF_COUNTERS_6_VAL_ADDR A:0x5849b8
y.create.l HWIO_SNOC_TPRB2_SPROF_COUNTERS_7_SRC_ADDR A:0x5849c4
y.create.l HWIO_SNOC_TPRB2_SPROF_COUNTERS_7_ALARMMODE_ADDR A:0x5849c8
y.create.l HWIO_SNOC_TPRB2_SPROF_COUNTERS_7_VAL_ADDR A:0x5849cc
y.create.l HWIO_SNOC_TPRB2_SPROF_COUNTERS_8_SRC_ADDR A:0x5849d8
y.create.l HWIO_SNOC_TPRB2_SPROF_COUNTERS_8_ALARMMODE_ADDR A:0x5849dc
y.create.l HWIO_SNOC_TPRB2_SPROF_COUNTERS_8_VAL_ADDR A:0x5849e0
y.create.l HWIO_SNOC_TPRB2_SPROF_COUNTERS_9_SRC_ADDR A:0x5849ec
y.create.l HWIO_SNOC_TPRB2_SPROF_COUNTERS_9_ALARMMODE_ADDR A:0x5849f0
y.create.l HWIO_SNOC_TPRB2_SPROF_COUNTERS_9_VAL_ADDR A:0x5849f4
y.create.l HWIO_SNOC_TPRB2_SPROF_COUNTERS_10_SRC_ADDR A:0x584a00
y.create.l HWIO_SNOC_TPRB2_SPROF_COUNTERS_10_ALARMMODE_ADDR A:0x584a04
y.create.l HWIO_SNOC_TPRB2_SPROF_COUNTERS_10_VAL_ADDR A:0x584a08
y.create.l HWIO_SNOC_TPRB2_SPROF_COUNTERS_11_SRC_ADDR A:0x584a14
y.create.l HWIO_SNOC_TPRB2_SPROF_COUNTERS_11_ALARMMODE_ADDR A:0x584a18
y.create.l HWIO_SNOC_TPRB2_SPROF_COUNTERS_11_VAL_ADDR A:0x584a1c
y.create.l HWIO_SNOC_TPRB2_SPROF_COUNTERS_12_SRC_ADDR A:0x584a28
y.create.l HWIO_SNOC_TPRB2_SPROF_COUNTERS_12_ALARMMODE_ADDR A:0x584a2c
y.create.l HWIO_SNOC_TPRB2_SPROF_COUNTERS_12_VAL_ADDR A:0x584a30
y.create.l HWIO_SNOC_TPRB2_SPROF_COUNTERS_13_SRC_ADDR A:0x584a3c
y.create.l HWIO_SNOC_TPRB2_SPROF_COUNTERS_13_ALARMMODE_ADDR A:0x584a40
y.create.l HWIO_SNOC_TPRB2_SPROF_COUNTERS_13_VAL_ADDR A:0x584a44
y.create.l HWIO_SNOC_TPRB2_SPROF_COUNTERS_14_SRC_ADDR A:0x584a50
y.create.l HWIO_SNOC_TPRB2_SPROF_COUNTERS_14_ALARMMODE_ADDR A:0x584a54
y.create.l HWIO_SNOC_TPRB2_SPROF_COUNTERS_14_VAL_ADDR A:0x584a58
y.create.l HWIO_SNOC_TPRB2_SPROF_COUNTERS_15_SRC_ADDR A:0x584a64
y.create.l HWIO_SNOC_TPRB2_SPROF_COUNTERS_15_ALARMMODE_ADDR A:0x584a68
y.create.l HWIO_SNOC_TPRB2_SPROF_COUNTERS_15_VAL_ADDR A:0x584a6c
y.create.l HWIO_SNOC_MSS_QOS_ID_COREID_ADDR A:0x587000
y.create.l HWIO_SNOC_MSS_QOS_ID_REVISIONID_ADDR A:0x587004
y.create.l HWIO_SNOC_MSS_QOS_PRIORITY_ADDR A:0x587008
y.create.l HWIO_SNOC_MSS_QOS_MODE_ADDR A:0x58700c
y.create.l HWIO_SNOC_MSS_QOS_BANDWIDTH_ADDR A:0x587010
y.create.l HWIO_SNOC_MSS_QOS_SATURATION_ADDR A:0x587014
y.create.l HWIO_SNOC_MSS_QOS_EXTCONTROL_ADDR A:0x587018
y.create.l HWIO_SNOC_MSS_NAV_QOS_ID_COREID_ADDR A:0x588000
y.create.l HWIO_SNOC_MSS_NAV_QOS_ID_REVISIONID_ADDR A:0x588004
y.create.l HWIO_SNOC_MSS_NAV_QOS_PRIORITY_ADDR A:0x588008
y.create.l HWIO_SNOC_MSS_NAV_QOS_MODE_ADDR A:0x58800c
y.create.l HWIO_SNOC_MSS_NAV_QOS_EXTCONTROL_ADDR A:0x588018
y.create.l HWIO_SNOC_WCSS_QOS_ID_COREID_ADDR A:0x58b000
y.create.l HWIO_SNOC_WCSS_QOS_ID_REVISIONID_ADDR A:0x58b004
y.create.l HWIO_SNOC_WCSS_QOS_PRIORITY_ADDR A:0x58b008
y.create.l HWIO_SNOC_WCSS_QOS_MODE_ADDR A:0x58b00c
y.create.l HWIO_SNOC_WCSS_QOS_EXTCONTROL_ADDR A:0x58b018
y.create.l HWIO_SNOC_PCNOC_QOS_ID_COREID_ADDR A:0x58c000
y.create.l HWIO_SNOC_PCNOC_QOS_ID_REVISIONID_ADDR A:0x58c004
y.create.l HWIO_SNOC_PCNOC_QOS_PRIORITY_ADDR A:0x58c008
y.create.l HWIO_SNOC_PCNOC_QOS_MODE_ADDR A:0x58c00c
y.create.l HWIO_SNOC_PCNOC_QOS_BANDWIDTH_ADDR A:0x58c010
y.create.l HWIO_SNOC_PCNOC_QOS_SATURATION_ADDR A:0x58c014
y.create.l HWIO_SNOC_PCNOC_QOS_EXTCONTROL_ADDR A:0x58c018
y.create.l HWIO_SNOC_MDP0_QOS_ID_COREID_ADDR A:0x58e000
y.create.l HWIO_SNOC_MDP0_QOS_ID_REVISIONID_ADDR A:0x58e004
y.create.l HWIO_SNOC_MDP0_QOS_PRIORITY_ADDR A:0x58e008
y.create.l HWIO_SNOC_MDP0_QOS_MODE_ADDR A:0x58e00c
y.create.l HWIO_SNOC_MDP0_QOS_EXTCONTROL_ADDR A:0x58e018
y.create.l HWIO_SNOC_VENUS0_QOS_ID_COREID_ADDR A:0x58f000
y.create.l HWIO_SNOC_VENUS0_QOS_ID_REVISIONID_ADDR A:0x58f004
y.create.l HWIO_SNOC_VENUS0_QOS_PRIORITY_ADDR A:0x58f008
y.create.l HWIO_SNOC_VENUS0_QOS_MODE_ADDR A:0x58f00c
y.create.l HWIO_SNOC_VENUS0_QOS_BANDWIDTH_ADDR A:0x58f010
y.create.l HWIO_SNOC_VENUS0_QOS_SATURATION_ADDR A:0x58f014
y.create.l HWIO_SNOC_VENUS0_QOS_EXTCONTROL_ADDR A:0x58f018
y.create.l HWIO_SNOC_VFE_QOS_ID_COREID_ADDR A:0x590000
y.create.l HWIO_SNOC_VFE_QOS_ID_REVISIONID_ADDR A:0x590004
y.create.l HWIO_SNOC_VFE_QOS_PRIORITY_ADDR A:0x590008
y.create.l HWIO_SNOC_VFE_QOS_MODE_ADDR A:0x59000c
y.create.l HWIO_SNOC_VFE_QOS_EXTCONTROL_ADDR A:0x590018
y.create.l HWIO_SNOC_QDSS_ETR_QOS_ID_COREID_ADDR A:0x591000
y.create.l HWIO_SNOC_QDSS_ETR_QOS_ID_REVISIONID_ADDR A:0x591004
y.create.l HWIO_SNOC_QDSS_ETR_QOS_PRIORITY_ADDR A:0x591008
y.create.l HWIO_SNOC_QDSS_ETR_QOS_MODE_ADDR A:0x59100c
y.create.l HWIO_SNOC_QDSS_ETR_QOS_EXTCONTROL_ADDR A:0x591018
y.create.l HWIO_SNOC_QDSS_BAM_QOS_ID_COREID_ADDR A:0x592000
y.create.l HWIO_SNOC_QDSS_BAM_QOS_ID_REVISIONID_ADDR A:0x592004
y.create.l HWIO_SNOC_QDSS_BAM_QOS_PRIORITY_ADDR A:0x592008
y.create.l HWIO_SNOC_QDSS_BAM_QOS_MODE_ADDR A:0x59200c
y.create.l HWIO_SNOC_QDSS_BAM_QOS_EXTCONTROL_ADDR A:0x592018
y.create.l HWIO_TLMM_XPU_SCR_ADDR A:0x1300000
y.create.l HWIO_TLMM_XPU_SWDR_ADDR A:0x1300004
y.create.l HWIO_TLMM_XPU_PRTN_RACR_SSHADOW_ADDR A:0x1300008
y.create.l HWIO_TLMM_XPU_PRTN_WACR_SSHADOW_ADDR A:0x130000c
y.create.l HWIO_TLMM_XPU_PRTN_START_SSHADOW0_ADDR A:0x1300010
y.create.l HWIO_TLMM_XPU_PRTN_END_SSHADOW0_ADDR A:0x1300018
y.create.l HWIO_TLMM_XPU_SEAR0_ADDR A:0x1300040
y.create.l HWIO_TLMM_XPU_SESR_ADDR A:0x1300048
y.create.l HWIO_TLMM_XPU_SESRRESTORE_ADDR A:0x130004c
y.create.l HWIO_TLMM_XPU_SESYNR0_ADDR A:0x1300050
y.create.l HWIO_TLMM_XPU_SESYNR1_ADDR A:0x1300054
y.create.l HWIO_TLMM_XPU_SESYNR2_ADDR A:0x1300058
y.create.l HWIO_TLMM_XPU_MCR_ADDR A:0x1300100
y.create.l HWIO_TLMM_XPU_MEAR0_ADDR A:0x1300140
y.create.l HWIO_TLMM_XPU_MESR_ADDR A:0x1300148
y.create.l HWIO_TLMM_XPU_MESRRESTORE_ADDR A:0x130014c
y.create.l HWIO_TLMM_XPU_MESYNR0_ADDR A:0x1300150
y.create.l HWIO_TLMM_XPU_MESYNR1_ADDR A:0x1300154
y.create.l HWIO_TLMM_XPU_MESYNR2_ADDR A:0x1300158
y.create.l HWIO_TLMM_XPU_CR_ADDR A:0x1300080
y.create.l HWIO_TLMM_XPU_PRTN_RACR_SHADOW_ADDR A:0x1300088
y.create.l HWIO_TLMM_XPU_PRTN_WACR_SHADOW_ADDR A:0x130008c
y.create.l HWIO_TLMM_XPU_PRTN_START_SHADOW0_ADDR A:0x1300090
y.create.l HWIO_TLMM_XPU_PRTN_END_SHADOW0_ADDR A:0x1300098
y.create.l HWIO_TLMM_XPU_RPU_ACR0_ADDR A:0x13000a0
y.create.l HWIO_TLMM_XPU_EAR0_ADDR A:0x13000c0
y.create.l HWIO_TLMM_XPU_ESR_ADDR A:0x13000c8
y.create.l HWIO_TLMM_XPU_ESRRESTORE_ADDR A:0x13000cc
y.create.l HWIO_TLMM_XPU_ESYNR0_ADDR A:0x13000d0
y.create.l HWIO_TLMM_XPU_ESYNR1_ADDR A:0x13000d4
y.create.l HWIO_TLMM_XPU_ESYNR2_ADDR A:0x13000d8
y.create.l HWIO_TLMM_XPU_UMR_RACR_ADDR A:0x13000e0
y.create.l HWIO_TLMM_XPU_UMR_WACR_ADDR A:0x13000e4
y.create.l HWIO_TLMM_XPU_UMR_CNTL_ADDR A:0x13000f0
y.create.l HWIO_TLMM_XPU_IDR0_ADDR A:0x1300074
y.create.l HWIO_TLMM_XPU_IDR1_ADDR A:0x1300078
y.create.l HWIO_TLMM_XPU_REV_ADDR A:0x130007c
y.create.l HWIO_TLMM_XPU_PRT0_RACR0_ADDR A:0x1300200
y.create.l HWIO_TLMM_XPU_PRT1_RACR0_ADDR A:0x1300280
y.create.l HWIO_TLMM_XPU_PRT2_RACR0_ADDR A:0x1300300
y.create.l HWIO_TLMM_XPU_PRT3_RACR0_ADDR A:0x1300380
y.create.l HWIO_TLMM_XPU_PRT4_RACR0_ADDR A:0x1300400
y.create.l HWIO_TLMM_XPU_PRT5_RACR0_ADDR A:0x1300480
y.create.l HWIO_TLMM_XPU_PRT6_RACR0_ADDR A:0x1300500
y.create.l HWIO_TLMM_XPU_PRT7_RACR0_ADDR A:0x1300580
y.create.l HWIO_TLMM_XPU_PRT8_RACR0_ADDR A:0x1300600
y.create.l HWIO_TLMM_XPU_PRT9_RACR0_ADDR A:0x1300680
y.create.l HWIO_TLMM_XPU_PRT0_WACR0_ADDR A:0x1300220
y.create.l HWIO_TLMM_XPU_PRT1_WACR0_ADDR A:0x13002a0
y.create.l HWIO_TLMM_XPU_PRT2_WACR0_ADDR A:0x1300320
y.create.l HWIO_TLMM_XPU_PRT3_WACR0_ADDR A:0x13003a0
y.create.l HWIO_TLMM_XPU_PRT4_WACR0_ADDR A:0x1300420
y.create.l HWIO_TLMM_XPU_PRT5_WACR0_ADDR A:0x13004a0
y.create.l HWIO_TLMM_XPU_PRT6_WACR0_ADDR A:0x1300520
y.create.l HWIO_TLMM_XPU_PRT7_WACR0_ADDR A:0x13005a0
y.create.l HWIO_TLMM_XPU_PRT8_WACR0_ADDR A:0x1300620
y.create.l HWIO_TLMM_XPU_PRT9_WACR0_ADDR A:0x13006a0
y.create.l HWIO_TLMM_XPU_PRT0_START0_ADDR A:0x1300240
y.create.l HWIO_TLMM_XPU_PRT1_START0_ADDR A:0x13002c0
y.create.l HWIO_TLMM_XPU_PRT2_START0_ADDR A:0x1300340
y.create.l HWIO_TLMM_XPU_PRT3_START0_ADDR A:0x13003c0
y.create.l HWIO_TLMM_XPU_PRT4_START0_ADDR A:0x1300440
y.create.l HWIO_TLMM_XPU_PRT5_START0_ADDR A:0x13004c0
y.create.l HWIO_TLMM_XPU_PRT6_START0_ADDR A:0x1300540
y.create.l HWIO_TLMM_XPU_PRT7_START0_ADDR A:0x13005c0
y.create.l HWIO_TLMM_XPU_PRT8_START0_ADDR A:0x1300640
y.create.l HWIO_TLMM_XPU_PRT9_START0_ADDR A:0x13006c0
y.create.l HWIO_TLMM_XPU_PRT0_END0_ADDR A:0x1300248
y.create.l HWIO_TLMM_XPU_PRT1_END0_ADDR A:0x13002c8
y.create.l HWIO_TLMM_XPU_PRT2_END0_ADDR A:0x1300348
y.create.l HWIO_TLMM_XPU_PRT3_END0_ADDR A:0x13003c8
y.create.l HWIO_TLMM_XPU_PRT4_END0_ADDR A:0x1300448
y.create.l HWIO_TLMM_XPU_PRT5_END0_ADDR A:0x13004c8
y.create.l HWIO_TLMM_XPU_PRT6_END0_ADDR A:0x1300548
y.create.l HWIO_TLMM_XPU_PRT7_END0_ADDR A:0x13005c8
y.create.l HWIO_TLMM_XPU_PRT8_END0_ADDR A:0x1300648
y.create.l HWIO_TLMM_XPU_PRT9_END0_ADDR A:0x13006c8
y.create.l HWIO_TLMM_XPU_PRT0_SCR_ADDR A:0x1300250
y.create.l HWIO_TLMM_XPU_PRT1_SCR_ADDR A:0x13002d0
y.create.l HWIO_TLMM_XPU_PRT2_SCR_ADDR A:0x1300350
y.create.l HWIO_TLMM_XPU_PRT3_SCR_ADDR A:0x13003d0
y.create.l HWIO_TLMM_XPU_PRT4_SCR_ADDR A:0x1300450
y.create.l HWIO_TLMM_XPU_PRT5_SCR_ADDR A:0x13004d0
y.create.l HWIO_TLMM_XPU_PRT6_SCR_ADDR A:0x1300550
y.create.l HWIO_TLMM_XPU_PRT7_SCR_ADDR A:0x13005d0
y.create.l HWIO_TLMM_XPU_PRT8_SCR_ADDR A:0x1300650
y.create.l HWIO_TLMM_XPU_PRT9_SCR_ADDR A:0x13006d0
y.create.l HWIO_TLMM_XPU_PRT0_MCR_ADDR A:0x1300254
y.create.l HWIO_TLMM_XPU_PRT1_MCR_ADDR A:0x13002d4
y.create.l HWIO_TLMM_XPU_PRT2_MCR_ADDR A:0x1300354
y.create.l HWIO_TLMM_XPU_PRT3_MCR_ADDR A:0x13003d4
y.create.l HWIO_TLMM_XPU_PRT4_MCR_ADDR A:0x1300454
y.create.l HWIO_TLMM_XPU_PRT5_MCR_ADDR A:0x13004d4
y.create.l HWIO_TLMM_XPU_PRT6_MCR_ADDR A:0x1300554
y.create.l HWIO_TLMM_XPU_PRT7_MCR_ADDR A:0x13005d4
y.create.l HWIO_TLMM_XPU_PRT8_MCR_ADDR A:0x1300654
y.create.l HWIO_TLMM_XPU_PRT9_MCR_ADDR A:0x13006d4
y.create.l HWIO_TLMM_XPU_PRT0_CNTL0_ADDR A:0x1300258
y.create.l HWIO_TLMM_XPU_PRT1_CNTL0_ADDR A:0x13002d8
y.create.l HWIO_TLMM_XPU_PRT2_CNTL0_ADDR A:0x1300358
y.create.l HWIO_TLMM_XPU_PRT3_CNTL0_ADDR A:0x13003d8
y.create.l HWIO_TLMM_XPU_PRT4_CNTL0_ADDR A:0x1300458
y.create.l HWIO_TLMM_XPU_PRT5_CNTL0_ADDR A:0x13004d8
y.create.l HWIO_TLMM_XPU_PRT6_CNTL0_ADDR A:0x1300558
y.create.l HWIO_TLMM_XPU_PRT7_CNTL0_ADDR A:0x13005d8
y.create.l HWIO_TLMM_XPU_PRT8_CNTL0_ADDR A:0x1300658
y.create.l HWIO_TLMM_XPU_PRT9_CNTL0_ADDR A:0x13006d8
y.create.l HWIO_TLMM_XPU_PRT0_CNTL1_ADDR A:0x130025c
y.create.l HWIO_TLMM_XPU_PRT1_CNTL1_ADDR A:0x13002dc
y.create.l HWIO_TLMM_XPU_PRT2_CNTL1_ADDR A:0x130035c
y.create.l HWIO_TLMM_XPU_PRT3_CNTL1_ADDR A:0x13003dc
y.create.l HWIO_TLMM_XPU_PRT4_CNTL1_ADDR A:0x130045c
y.create.l HWIO_TLMM_XPU_PRT5_CNTL1_ADDR A:0x13004dc
y.create.l HWIO_TLMM_XPU_PRT6_CNTL1_ADDR A:0x130055c
y.create.l HWIO_TLMM_XPU_PRT7_CNTL1_ADDR A:0x13005dc
y.create.l HWIO_TLMM_XPU_PRT8_CNTL1_ADDR A:0x130065c
y.create.l HWIO_TLMM_XPU_PRT9_CNTL1_ADDR A:0x13006dc
y.create.l HWIO_TLMM_GPIO_CFG0_ADDR A:0x1000000
y.create.l HWIO_TLMM_GPIO_CFG1_ADDR A:0x1001000
y.create.l HWIO_TLMM_GPIO_CFG2_ADDR A:0x1002000
y.create.l HWIO_TLMM_GPIO_CFG3_ADDR A:0x1003000
y.create.l HWIO_TLMM_GPIO_CFG4_ADDR A:0x1004000
y.create.l HWIO_TLMM_GPIO_CFG5_ADDR A:0x1005000
y.create.l HWIO_TLMM_GPIO_CFG6_ADDR A:0x1006000
y.create.l HWIO_TLMM_GPIO_CFG7_ADDR A:0x1007000
y.create.l HWIO_TLMM_GPIO_CFG8_ADDR A:0x1008000
y.create.l HWIO_TLMM_GPIO_CFG9_ADDR A:0x1009000
y.create.l HWIO_TLMM_GPIO_IN_OUT0_ADDR A:0x1000004
y.create.l HWIO_TLMM_GPIO_IN_OUT1_ADDR A:0x1001004
y.create.l HWIO_TLMM_GPIO_IN_OUT2_ADDR A:0x1002004
y.create.l HWIO_TLMM_GPIO_IN_OUT3_ADDR A:0x1003004
y.create.l HWIO_TLMM_GPIO_IN_OUT4_ADDR A:0x1004004
y.create.l HWIO_TLMM_GPIO_IN_OUT5_ADDR A:0x1005004
y.create.l HWIO_TLMM_GPIO_IN_OUT6_ADDR A:0x1006004
y.create.l HWIO_TLMM_GPIO_IN_OUT7_ADDR A:0x1007004
y.create.l HWIO_TLMM_GPIO_IN_OUT8_ADDR A:0x1008004
y.create.l HWIO_TLMM_GPIO_IN_OUT9_ADDR A:0x1009004
y.create.l HWIO_TLMM_GPIO_INTR_CFG0_ADDR A:0x1000008
y.create.l HWIO_TLMM_GPIO_INTR_CFG1_ADDR A:0x1001008
y.create.l HWIO_TLMM_GPIO_INTR_CFG2_ADDR A:0x1002008
y.create.l HWIO_TLMM_GPIO_INTR_CFG3_ADDR A:0x1003008
y.create.l HWIO_TLMM_GPIO_INTR_CFG4_ADDR A:0x1004008
y.create.l HWIO_TLMM_GPIO_INTR_CFG5_ADDR A:0x1005008
y.create.l HWIO_TLMM_GPIO_INTR_CFG6_ADDR A:0x1006008
y.create.l HWIO_TLMM_GPIO_INTR_CFG7_ADDR A:0x1007008
y.create.l HWIO_TLMM_GPIO_INTR_CFG8_ADDR A:0x1008008
y.create.l HWIO_TLMM_GPIO_INTR_CFG9_ADDR A:0x1009008
y.create.l HWIO_TLMM_GPIO_INTR_STATUS0_ADDR A:0x100000c
y.create.l HWIO_TLMM_GPIO_INTR_STATUS1_ADDR A:0x100100c
y.create.l HWIO_TLMM_GPIO_INTR_STATUS2_ADDR A:0x100200c
y.create.l HWIO_TLMM_GPIO_INTR_STATUS3_ADDR A:0x100300c
y.create.l HWIO_TLMM_GPIO_INTR_STATUS4_ADDR A:0x100400c
y.create.l HWIO_TLMM_GPIO_INTR_STATUS5_ADDR A:0x100500c
y.create.l HWIO_TLMM_GPIO_INTR_STATUS6_ADDR A:0x100600c
y.create.l HWIO_TLMM_GPIO_INTR_STATUS7_ADDR A:0x100700c
y.create.l HWIO_TLMM_GPIO_INTR_STATUS8_ADDR A:0x100800c
y.create.l HWIO_TLMM_GPIO_INTR_STATUS9_ADDR A:0x100900c
y.create.l HWIO_TLMM_CLK_GATE_EN_ADDR A:0x1100000
y.create.l HWIO_TLMM_IE_CTRL_DISABLE_ADDR A:0x1100004
y.create.l HWIO_TLMM_MPM_WAKEUP_INT_EN_0_ADDR A:0x1100008
y.create.l HWIO_TLMM_MPM_WAKEUP_INT_EN_1_ADDR A:0x110000c
y.create.l HWIO_TLMM_INT_JTAG_CTL_ADDR A:0x1110000
y.create.l HWIO_TLMM_ETM_MODE_ADDR A:0x1110004
y.create.l HWIO_TLMM_DBG_BUS_OUT_SEL_ADDR A:0x1110008
y.create.l HWIO_TLMM_CHIP_MODE_ADDR A:0x111000c
y.create.l HWIO_TLMM_SPARE_ADDR A:0x110e000
y.create.l HWIO_SPARE1_ADDR A:0x111001c
y.create.l HWIO_SPARE2_ADDR A:0x1110020
y.create.l HWIO_TLMM_HW_REVISION_NUMBER_ADDR A:0x1110010
y.create.l HWIO_TLMM_PERIPH_CHAR_TEST_MODE_ADDR A:0x1110014
y.create.l HWIO_TLMM_EBI2_EMMC_GPIO_CFG_ADDR A:0x1111000
y.create.l HWIO_TLMM_PBL_DEBUG_ADDR A:0x1110018
y.create.l HWIO_TLMM_RFFE_CTL_ADDR A:0x1108000
y.create.l HWIO_TLMM_RESOUT_HDRV_CTL_ADDR A:0x110d000
y.create.l HWIO_TLMM_JTAG_HDRV_CTL_ADDR A:0x110c000
y.create.l HWIO_TLMM_PMIC_HDRV_PULL_CTL_ADDR A:0x110b000
y.create.l HWIO_TLMM_SDC1_HDRV_PULL_CTL_ADDR A:0x110a000
y.create.l HWIO_TLMM_SDC2_HDRV_PULL_CTL_ADDR A:0x1109000
y.create.l HWIO_TLMM_MODE_PULL_CTL_ADDR A:0x1107000
y.create.l HWIO_TLMM_QDSD_HDRV_PULL_DEBUG_GPIO_CTL_ADDR A:0x119c000
y.create.l HWIO_TLMM_QDSD_BOOT_CTL_ADDR A:0x119d000
y.create.l HWIO_TLMM_QDSD_CONFIG_CTL_ADDR A:0x119e000
y.create.l HWIO_TLMM_QDSD_STATUS_CTL_ADDR A:0x119f000
y.create.l HWIO_TLMM_QDSD_HYS_CTL_ADDR A:0x11a7000
y.create.l HWIO_TLMM_QDSD_DEBUG_HDRV_PULL_CTL_ADDR A:0x11a0000
y.create.l HWIO_TLMM_QDSD_GPIO_CTL_ADDR A:0x11a1000
y.create.l HWIO_TLMM_QDSD_INTR_ENABLE_CTL_ADDR A:0x11a2000
y.create.l HWIO_TLMM_QDSD_INTR_CLEAR_CTL_ADDR A:0x11a3000
y.create.l HWIO_TLMM_QDSD_SPARE1_CTL_ADDR A:0x11a5000
y.create.l HWIO_TLMM_QDSD_SPARE2_CTL_ADDR A:0x11a6000
y.create.l HWIO_TLMM_QDSD_TIMEOUT_VALUE_CTL_ADDR A:0x11a4000
y.create.l HWIO_TLMM_GPIO_HS_I2C_CTL_ADDR A:0x110f000
y.create.l HWIO_TLMM_DIR_CONN_INTR0_CFG_WCSS_ADDR A:0x1106000
y.create.l HWIO_TLMM_DIR_CONN_INTR1_CFG_WCSS_ADDR A:0x1106004
y.create.l HWIO_TLMM_DIR_CONN_INTR0_CFG_SENSORS_ADDR A:0x1105000
y.create.l HWIO_TLMM_DIR_CONN_INTR1_CFG_SENSORS_ADDR A:0x1105004
y.create.l HWIO_TLMM_DIR_CONN_INTR2_CFG_SENSORS_ADDR A:0x1105008
y.create.l HWIO_TLMM_DIR_CONN_INTR3_CFG_SENSORS_ADDR A:0x110500c
y.create.l HWIO_TLMM_DIR_CONN_INTR4_CFG_SENSORS_ADDR A:0x1105010
y.create.l HWIO_TLMM_DIR_CONN_INTR5_CFG_SENSORS_ADDR A:0x1105014
y.create.l HWIO_TLMM_DIR_CONN_INTR6_CFG_SENSORS_ADDR A:0x1105018
y.create.l HWIO_TLMM_DIR_CONN_INTR7_CFG_SENSORS_ADDR A:0x110501c
y.create.l HWIO_TLMM_DIR_CONN_INTR8_CFG_SENSORS_ADDR A:0x1105020
y.create.l HWIO_TLMM_DIR_CONN_INTR9_CFG_SENSORS_ADDR A:0x1105024
y.create.l HWIO_TLMM_DIR_CONN_INTR0_CFG_LPA_DSP_ADDR A:0x1104000
y.create.l HWIO_TLMM_DIR_CONN_INTR1_CFG_LPA_DSP_ADDR A:0x1104004
y.create.l HWIO_TLMM_DIR_CONN_INTR2_CFG_LPA_DSP_ADDR A:0x1104008
y.create.l HWIO_TLMM_DIR_CONN_INTR3_CFG_LPA_DSP_ADDR A:0x110400c
y.create.l HWIO_TLMM_DIR_CONN_INTR4_CFG_LPA_DSP_ADDR A:0x1104010
y.create.l HWIO_TLMM_DIR_CONN_INTR5_CFG_LPA_DSP_ADDR A:0x1104014
y.create.l HWIO_TLMM_DIR_CONN_INTR0_CFG_RPM_ADDR A:0x1103000
y.create.l HWIO_TLMM_DIR_CONN_INTR0_CFG_APSS_ADDR A:0x1102000
y.create.l HWIO_TLMM_DIR_CONN_INTR1_CFG_APSS_ADDR A:0x1102004
y.create.l HWIO_TLMM_DIR_CONN_INTR2_CFG_APSS_ADDR A:0x1102008
y.create.l HWIO_TLMM_DIR_CONN_INTR3_CFG_APSS_ADDR A:0x110200c
y.create.l HWIO_TLMM_DIR_CONN_INTR4_CFG_APSS_ADDR A:0x1102010
y.create.l HWIO_TLMM_DIR_CONN_INTR5_CFG_APSS_ADDR A:0x1102014
y.create.l HWIO_TLMM_DIR_CONN_INTR6_CFG_APSS_ADDR A:0x1102018
y.create.l HWIO_TLMM_DIR_CONN_INTR7_CFG_APSS_ADDR A:0x110201c
y.create.l HWIO_TLMM_DIR_CONN_INTR0_CFG_MSS_ADDR A:0x1101000
y.create.l HWIO_TLMM_DIR_CONN_INTR1_CFG_MSS_ADDR A:0x1101004
y.create.l HWIO_TLMM_GPIO_OUT_0_ADDR A:0x1200000
y.create.l HWIO_TLMM_GPIO_OUT_1_ADDR A:0x1200004
y.create.l HWIO_TLMM_GPIO_OUT_2_ADDR A:0x1200008
y.create.l HWIO_TLMM_GPIO_OUT_3_ADDR A:0x120000c
y.create.l HWIO_TLMM_GPIO_OUT_CLR_0_ADDR A:0x1200020
y.create.l HWIO_TLMM_GPIO_OUT_CLR_1_ADDR A:0x1200024
y.create.l HWIO_TLMM_GPIO_OUT_CLR_2_ADDR A:0x1200028
y.create.l HWIO_TLMM_GPIO_OUT_CLR_3_ADDR A:0x120002c
y.create.l HWIO_TLMM_GPIO_OUT_SET_0_ADDR A:0x1200040
y.create.l HWIO_TLMM_GPIO_OUT_SET_1_ADDR A:0x1200044
y.create.l HWIO_TLMM_GPIO_OUT_SET_2_ADDR A:0x1200048
y.create.l HWIO_TLMM_GPIO_OUT_SET_3_ADDR A:0x120004c
y.create.l HWIO_TLMM_GPIO_IN_0_ADDR A:0x1200060
y.create.l HWIO_TLMM_GPIO_IN_1_ADDR A:0x1200064
y.create.l HWIO_TLMM_GPIO_IN_2_ADDR A:0x1200068
y.create.l HWIO_TLMM_GPIO_IN_3_ADDR A:0x120006c
y.create.l HWIO_TLMM_GPIO_OE_0_ADDR A:0x1200080
y.create.l HWIO_TLMM_GPIO_OE_1_ADDR A:0x1200084
y.create.l HWIO_TLMM_GPIO_OE_2_ADDR A:0x1200088
y.create.l HWIO_TLMM_GPIO_OE_3_ADDR A:0x120008c
y.create.l HWIO_TLMM_GPIO_OE_CLR_0_ADDR A:0x12000a0
y.create.l HWIO_TLMM_GPIO_OE_CLR_1_ADDR A:0x12000a4
y.create.l HWIO_TLMM_GPIO_OE_CLR_2_ADDR A:0x12000a8
y.create.l HWIO_TLMM_GPIO_OE_CLR_3_ADDR A:0x12000ac
y.create.l HWIO_TLMM_GPIO_OE_SET_0_ADDR A:0x12000c0
y.create.l HWIO_TLMM_GPIO_OE_SET_1_ADDR A:0x12000c4
y.create.l HWIO_TLMM_GPIO_OE_SET_2_ADDR A:0x12000c8
y.create.l HWIO_TLMM_GPIO_OE_SET_3_ADDR A:0x12000cc
y.create.l HWIO_ULTAUDIO_HW_VERSION_ADDR A:0x7700000
y.create.l HWIO_ULTAUDIO_TCSR_DEBUG_CTL_ADDR A:0x7700004
y.create.l HWIO_LPASS_CSR_GP_CTL_ADDR A:0x7700100
y.create.l HWIO_LPASS_CSR_MEMTYPE_CTL_ADDR A:0x7700104
y.create.l HWIO_LPASS_CSR_DEBUG_BUS_ADDR A:0x7700114
y.create.l HWIO_LPASS_AHBI_CFG_ADDR A:0x7700124
y.create.l HWIO_LPASS_AHBI_LOCK_CTL_ADDR A:0x7700128
y.create.l HWIO_LPASS_AHBI_CFG_EXT_ADDR A:0x770012c
y.create.l HWIO_LPASS_AHBX_CFG_ADDR A:0x7700140
y.create.l HWIO_LPASS_AHBX_LOCK_CTL_ADDR A:0x7700144
y.create.l HWIO_LPASS_AHBIX_SSR_CTL_ADDR A:0x7700148
y.create.l HWIO_LPASS_AHBIX_STATUS_ADDR A:0x7700150
y.create.l HWIO_LPASS_AHBIX_ACK_ADDR A:0x7700154
y.create.l HWIO_LPASS_AHBIX_EN_ADDR A:0x7700158
y.create.l HWIO_LPASS_AUDIO_CORE_LPM_CGCR_ADDR A:0x770015c
y.create.l HWIO_LPASS_AUDIO_CORE_AUDSYNC_CGCR_ADDR A:0x7700160
y.create.l HWIO_LPASS_AUDIO_CORE_AVSYNC_CGCR_ADDR A:0x7700164
y.create.l HWIO_LPASS_AUDIO_CORE_AHB2AHB_CODEC_CGCR_ADDR A:0x770016c
y.create.l HWIO_LPASS_AUDIO_CORE_LPAIF_CTL_CGCR_ADDR A:0x7700170
y.create.l HWIO_LPASS_AUDIO_CORE_VFR_CGCR_ADDR A:0x7700174
y.create.l HWIO_LPASS_AUDIO_CORE_AHB2AHB_PCNOC_SLV_CGCR_ADDR A:0x7700178
y.create.l HWIO_LPASS_AUDIO_CORE_AHB2AHB_PCNOC_MST_CGCR_ADDR A:0x770017c
y.create.l HWIO_LPASS_AUDIO_CORE_AVTIMER_XO_FM_CGCR_ADDR A:0x7700180
y.create.l HWIO_LPASS_AUDIO_CORE_AVTIMER_XO_BT_CGCR_ADDR A:0x7700184
y.create.l HWIO_LPASS_AUDIO_CORE_SLIMBUS_SLV_CGCR_ADDR A:0x7700188
y.create.l HWIO_LPASS_AUDIO_CORE_SLIMBUS_MST_CGCR_ADDR A:0x770018c
y.create.l HWIO_LPASS_LPASS_CSR_ADDR_VALID_STATUS_ADDR A:0x7700190
y.create.l HWIO_LPASS_LPASS_CSR_ADDR_VALID_ACK_ADDR A:0x7700194
y.create.l HWIO_LPASS_LPASS_CSR_ADDR_VALID_EN_ADDR A:0x7700198
y.create.l HWIO_LPASS_LPM_CTL_ADDR A:0x770019c
y.create.l HWIO_LPASS_LPAIF_CTL_ADDR A:0x77001b0
y.create.l HWIO_LPASS_VFR_IRQ_MUX_CTL_ADDR A:0x7701000
y.create.l HWIO_LPASS_VFR_STC_MSB_ADDR A:0x7701004
y.create.l HWIO_LPASS_VFR_STC_LSB_ADDR A:0x7701008
y.create.l HWIO_LPASS_VFR_IRQ_MUX_CTL_1_ADDR A:0x7701010
y.create.l HWIO_LPASS_VFR_STC_MSB_1_ADDR A:0x7701014
y.create.l HWIO_LPASS_VFR_STC_LSB_1_ADDR A:0x7701018
y.create.l HWIO_LPASS_GP_IRQ_TS_MUX_CTL_0_ADDR A:0x7701020
y.create.l HWIO_LPASS_GP_IRQ_STC_MSB_0_ADDR A:0x7701024
y.create.l HWIO_LPASS_GP_IRQ_STC_LSB_0_ADDR A:0x7701028
y.create.l HWIO_LPASS_GP_IRQ_TS_MUX_CTL_1_ADDR A:0x7701030
y.create.l HWIO_LPASS_GP_IRQ_STC_MSB_1_ADDR A:0x7701034
y.create.l HWIO_LPASS_GP_IRQ_STC_LSB_1_ADDR A:0x7701038
y.create.l HWIO_LPASS_LPAIF_VFR_IRQ_CTL_ADDR A:0x7701040
y.create.l HWIO_LPASS_WCN_VFR_IRQ_CTL_ADDR A:0x7701044
y.create.l HWIO_LPASS_AVT_VFR_IRQ_CTL_ADDR A:0x7701048
y.create.l HWIO_LPASS_SLIMBUS_VFR_IRQ_CTL_ADDR A:0x770104c
y.create.l HWIO_LPASS_CSR_GP_IO_MUX_MIC_CTL_ADDR A:0x7702000
y.create.l HWIO_LPASS_CSR_GP_IO_MUX_SPKR_CTL_ADDR A:0x7702004
y.create.l HWIO_LPASS_CSR_GP_LPAIF_PRI_PCM_PRI_MODE_MUXSEL_ADDR A:0x7702008
y.create.l HWIO_LPASS_CSR_GP_LPAIF_SEC_PCM_SEC_MODE_MUXSEL_ADDR A:0x770200c
y.create.l HWIO_LPASS_CSR_GP_LPAIF_TER_PCM_PRI_MODE_MUXSEL_ADDR A:0x7702010
y.create.l HWIO_LPASS_AHBI_ABT_HW_VERSION_ADDR A:0x7705000
y.create.l HWIO_LPASS_AHBI_ABT_INST_ID_ADDR A:0x7705004
y.create.l HWIO_LPASS_AHBI_ABT_NUM_SLAVES_ADDR A:0x7705008
y.create.l HWIO_LPASS_AHBI_ABT_TIMER_LOADVAL_ADDR A:0x770500c
y.create.l HWIO_LPASS_AHBI_ABT_TIMER_MODE_ADDR A:0x7705010
y.create.l HWIO_LPASS_AHBI_ABT_INTR_STATUS_ADDR A:0x7705014
y.create.l HWIO_LPASS_AHBI_ABT_INTR_CLEAR_ADDR A:0x7705018
y.create.l HWIO_LPASS_AHBI_ABT_INTR_ENABLE_ADDR A:0x770501c
y.create.l HWIO_LPASS_AHBI_ABT_SYND_VALID_ADDR A:0x7705020
y.create.l HWIO_LPASS_AHBI_ABT_SYND_CLEAR_ADDR A:0x7705024
y.create.l HWIO_LPASS_AHBI_ABT_SYND_ID_ADDR A:0x7705028
y.create.l HWIO_LPASS_AHBI_ABT_SYND_ADDR0_ADDR A:0x770502c
y.create.l HWIO_LPASS_AHBI_ABT_SYND_ADDR1_ADDR A:0x7705030
y.create.l HWIO_LPASS_AHBI_ABT_SYND_HREADY_ADDR A:0x7705034
y.create.l HWIO_LPASS_AVTIMER_HW_VERSION_ADDR A:0x7706000
y.create.l HWIO_LPASS_AVTIMER_CTL_ADDR A:0x7706004
y.create.l HWIO_LPASS_AVTIMER_RESMOD_ADDR A:0x7706008
y.create.l HWIO_LPASS_AVTIMER_TIMER_LSB_ADDR A:0x770600c
y.create.l HWIO_LPASS_AVTIMER_TIMER_MSB_ADDR A:0x7706010
y.create.l HWIO_LPASS_AVTIMER_INT0_LSB_ADDR A:0x7706014
y.create.l HWIO_LPASS_AVTIMER_INT0_MSB_ADDR A:0x7706018
y.create.l HWIO_LPASS_AVTIMER_INT1_LSB_ADDR A:0x770601c
y.create.l HWIO_LPASS_AVTIMER_INT1_MSB_ADDR A:0x7706020
y.create.l HWIO_LPASS_AVTIMER_TIMEOUT_VAL_ADDR A:0x7706024
y.create.l HWIO_LPASS_AVTIMER_L0_VAL_NEXT_ADDR A:0x7706028
y.create.l HWIO_LPASS_AVTIMER_M0_VAL_NEXT_ADDR A:0x770602c
y.create.l HWIO_LPASS_AVTIMER_N0_VAL_NEXT_ADDR A:0x7706030
y.create.l HWIO_LPASS_AVTIMER_L0_VAL_CURR_ADDR A:0x7706034
y.create.l HWIO_LPASS_AVTIMER_M0_VAL_CURR_ADDR A:0x7706038
y.create.l HWIO_LPASS_AVTIMER_N0_VAL_CURR_ADDR A:0x770603c
y.create.l HWIO_LPASS_AVTIMER_MODE_CTL_ADDR A:0x7706040
y.create.l HWIO_LPASS_AVTIMER_LMN_DWT_ADDR A:0x7706044
y.create.l HWIO_LPASS_AVTIMER_LTIME_LSB_ADDR A:0x7706048
y.create.l HWIO_LPASS_AVTIMER_LTIME_MSB_ADDR A:0x770604c
y.create.l HWIO_LPASS_AVTIMER_EXT_STC_LSB_ADDR A:0x7706050
y.create.l HWIO_LPASS_AVTIMER_EXT_STC_MSB_ADDR A:0x7706054
y.create.l HWIO_LPASS_AVTIMER_RTIME_LSB_ADDR A:0x7706058
y.create.l HWIO_LPASS_AVTIMER_RTIME_MSB_ADDR A:0x770605c
y.create.l HWIO_LPASS_AVTIMER_RTIME_CTL_ADDR A:0x7706060
y.create.l HWIO_LPASS_AVTIMER_TIME_CTL_ADDR A:0x7706064
y.create.l HWIO_LPASS_AVTIMER_TIMER_LOAD_LSB_NEXT_ADDR A:0x7706068
y.create.l HWIO_LPASS_AVTIMER_TIMER_LOAD_MSB_NEXT_ADDR A:0x770606c
y.create.l HWIO_LPASS_AVTIMER_TIMER_LOAD_LSB_CURR_ADDR A:0x7706070
y.create.l HWIO_LPASS_AVTIMER_TIMER_LOAD_MSB_CURR_ADDR A:0x7706074
y.create.l HWIO_LPASS_AVTIMER_TIMER_LOAD_DWT_ADDR A:0x7706078
y.create.l HWIO_LPASS_AVTIMER_INT1_ST_ADDR A:0x770607c
y.create.l HWIO_LPASS_AVTIMER_INT0_ST_ADDR A:0x7706080
y.create.l HWIO_LPASS_AVTIMER_INT1_CTL_ADDR A:0x7706084
y.create.l HWIO_LPASS_AVTIMER_INT0_CTL_ADDR A:0x7706088
y.create.l HWIO_LPASS_AVTIMER_INT_ON_ADDR A:0x770608c
y.create.l HWIO_LPASS_AVTIMER_TICK_DIV_ADDR A:0x7706090
y.create.l HWIO_LPASS_AUD_SYNC_CTL_ADDR A:0x7707000
y.create.l HWIO_LPASS_AUD_SYNC_STATUS_ADDR A:0x7707004
y.create.l HWIO_LPASS_AUD_SYNC_BT_REF_INC_ADDR A:0x7707008
y.create.l HWIO_LPASS_AUD_SYNC_BT_XO_DIV_MOD_ADDR A:0x770700c
y.create.l HWIO_LPASS_AUD_SYNC_BT_PHASE_CHK_XO1_ADDR A:0x7707010
y.create.l HWIO_LPASS_AUD_SYNC_BT_PHASE_CHK_REF1_ADDR A:0x7707014
y.create.l HWIO_LPASS_AUD_SYNC_BT_VFR_TIMESTAMP_ADDR A:0x7707018
y.create.l HWIO_LPASS_AUD_SYNC_BT_COUNT_LOAD_XO1_ADDR A:0x770701c
y.create.l HWIO_LPASS_AUD_SYNC_BT_COUNT_LOAD_REF1_ADDR A:0x7707020
y.create.l HWIO_LPASS_AUD_SYNC_BT_PHASE_CHK_XO2_ADDR A:0x7707024
y.create.l HWIO_LPASS_AUD_SYNC_BT_PHASE_CHK_REF2_ADDR A:0x7707028
y.create.l HWIO_LPASS_AUD_SYNC_BT_COUNT_LOAD_XO2_ADDR A:0x770702c
y.create.l HWIO_LPASS_AUD_SYNC_BT_COUNT_LOAD_REF2_ADDR A:0x7707030
y.create.l HWIO_LPASS_AUD_SYNC_FM_REF_INC_ADDR A:0x7707034
y.create.l HWIO_LPASS_AUD_SYNC_FM_XO_DIV_MOD_ADDR A:0x7707038
y.create.l HWIO_LPASS_AUD_SYNC_FM_PHASE_CHK_XO_ADDR A:0x770703c
y.create.l HWIO_LPASS_AUD_SYNC_FM_PHASE_CHK_REF_ADDR A:0x7707040
y.create.l HWIO_LPASS_AUD_SYNC_FM_VFR_TIMESTAMP_ADDR A:0x7707044
y.create.l HWIO_LPASS_AUD_SYNC_FM_COUNT_LOAD_XO_ADDR A:0x7707048
y.create.l HWIO_LPASS_AUD_SYNC_FM_COUNT_LOAD_REF_ADDR A:0x770704c
y.create.l HWIO_LPASS_LPAIF_VERSION_ADDR A:0x7708000
y.create.l HWIO_LPASS_LPAIF_HW_CONFIG_ADDR A:0x7708004
y.create.l HWIO_LPASS_LPAIF_HW_CONFIG2_ADDR A:0x7708008
y.create.l HWIO_LPASS_LPAIF_DMIC_CTL_ADDR A:0x7708080
y.create.l HWIO_LPASS_LPAIF_DMIC_VOL_CTL0_ADDR A:0x7708084
y.create.l HWIO_LPASS_LPAIF_DMIC_VOL_CTL1_ADDR A:0x7708088
y.create.l HWIO_LPASS_LPAIF_WRDMA_LPBK_MIX_ADDR A:0x7708100
y.create.l HWIO_LPASS_LPAIF_MIXER_CTL_ADDR A:0x7708180
y.create.l HWIO_LPASS_LPAIF_EXT_VFR_ADDR A:0x7708200
y.create.l HWIO_LPASS_LPAIF_DEBUG_CTL_ADDR A:0x7708280
y.create.l HWIO_LPASS_LPAIF_PRI_RATE_DET_CONFIG_ADDR A:0x7708300
y.create.l HWIO_LPASS_LPAIF_PRI_RATE_DET_TARGET1_CONFIG_ADDR A:0x7708304
y.create.l HWIO_LPASS_LPAIF_PRI_RATE_DET_TARGET2_CONFIG_ADDR A:0x7708308
y.create.l HWIO_LPASS_LPAIF_PRI_RATE_BIN_ADDR A:0x770830c
y.create.l HWIO_LPASS_LPAIF_PRI_STC_DIFF_ADDR A:0x7708310
y.create.l HWIO_LPASS_LPAIF_SEC_RATE_DET_CONFIG_ADDR A:0x7708380
y.create.l HWIO_LPASS_LPAIF_SEC_RATE_DET_TARGET1_CONFIG_ADDR A:0x7708384
y.create.l HWIO_LPASS_LPAIF_SEC_RATE_DET_TARGET2_CONFIG_ADDR A:0x7708388
y.create.l HWIO_LPASS_LPAIF_SEC_RATE_BIN_ADDR A:0x770838c
y.create.l HWIO_LPASS_LPAIF_SEC_STC_DIFF_ADDR A:0x7708390
y.create.l HWIO_LPASS_LPAIF_SPARE_ADDR A:0x7708400
y.create.l HWIO_LPASS_LPAIF_I2S_CTL0_ADDR A:0x7709000
y.create.l HWIO_LPASS_LPAIF_I2S_CTL1_ADDR A:0x770a000
y.create.l HWIO_LPASS_LPAIF_I2S_CTL2_ADDR A:0x770b000
y.create.l HWIO_LPASS_LPAIF_I2S_CTL3_ADDR A:0x770c000
y.create.l HWIO_LPASS_LPAIF_PCM_CTL0_ADDR A:0x7709040
y.create.l HWIO_LPASS_LPAIF_PCM_SLOT_CTL0_ADDR A:0x7709044
y.create.l HWIO_LPASS_LPAIF_PCM_SLOT_CTL2_0_ADDR A:0x7709048
y.create.l HWIO_LPASS_LPAIF_PCM_SLOT_CTL3_0_ADDR A:0x770904c
y.create.l HWIO_LPASS_LPAIF_PCM_TDM_CTL_0_ADDR A:0x7709050
y.create.l HWIO_LPASS_LPAIF_PCM_TDM_SAMPLE_WIDTH_0_ADDR A:0x7709054
y.create.l HWIO_LPASS_LPAIF_IRQ_EN0_ADDR A:0x770e000
y.create.l HWIO_LPASS_LPAIF_IRQ_EN1_ADDR A:0x770f000
y.create.l HWIO_LPASS_LPAIF_IRQ_EN2_ADDR A:0x7710000
y.create.l HWIO_LPASS_LPAIF_IRQ_STAT0_ADDR A:0x770e004
y.create.l HWIO_LPASS_LPAIF_IRQ_STAT1_ADDR A:0x770f004
y.create.l HWIO_LPASS_LPAIF_IRQ_STAT2_ADDR A:0x7710004
y.create.l HWIO_LPASS_LPAIF_IRQ_RAW_STAT0_ADDR A:0x770e008
y.create.l HWIO_LPASS_LPAIF_IRQ_RAW_STAT1_ADDR A:0x770f008
y.create.l HWIO_LPASS_LPAIF_IRQ_RAW_STAT2_ADDR A:0x7710008
y.create.l HWIO_LPASS_LPAIF_IRQ_CLEAR0_ADDR A:0x770e00c
y.create.l HWIO_LPASS_LPAIF_IRQ_CLEAR1_ADDR A:0x770f00c
y.create.l HWIO_LPASS_LPAIF_IRQ_CLEAR2_ADDR A:0x771000c
y.create.l HWIO_LPASS_LPAIF_IRQ_FORCE0_ADDR A:0x770e010
y.create.l HWIO_LPASS_LPAIF_IRQ_FORCE1_ADDR A:0x770f010
y.create.l HWIO_LPASS_LPAIF_IRQ_FORCE2_ADDR A:0x7710010
y.create.l HWIO_LPASS_LPAIF_RDDMA_CTL0_ADDR A:0x7710400
y.create.l HWIO_LPASS_LPAIF_RDDMA_CTL1_ADDR A:0x7711400
y.create.l HWIO_LPASS_LPAIF_RDDMA_BASE0_ADDR A:0x7710404
y.create.l HWIO_LPASS_LPAIF_RDDMA_BASE1_ADDR A:0x7711404
y.create.l HWIO_LPASS_LPAIF_RDDMA_BUFF_LEN0_ADDR A:0x7710408
y.create.l HWIO_LPASS_LPAIF_RDDMA_BUFF_LEN1_ADDR A:0x7711408
y.create.l HWIO_LPASS_LPAIF_RDDMA_CURR_ADDR0_ADDR A:0x771040c
y.create.l HWIO_LPASS_LPAIF_RDDMA_CURR_ADDR1_ADDR A:0x771140c
y.create.l HWIO_LPASS_LPAIF_RDDMA_PER_LEN0_ADDR A:0x7710410
y.create.l HWIO_LPASS_LPAIF_RDDMA_PER_LEN1_ADDR A:0x7711410
y.create.l HWIO_LPASS_LPAIF_RDDMA_PER_CNT0_ADDR A:0x7710414
y.create.l HWIO_LPASS_LPAIF_RDDMA_PER_CNT1_ADDR A:0x7711414
y.create.l HWIO_LPASS_LPAIF_RDDMA_FRM0_ADDR A:0x7710418
y.create.l HWIO_LPASS_LPAIF_RDDMA_FRM1_ADDR A:0x7711418
y.create.l HWIO_LPASS_LPAIF_RDDMA_FRMCLR0_ADDR A:0x771041c
y.create.l HWIO_LPASS_LPAIF_RDDMA_FRMCLR1_ADDR A:0x771141c
y.create.l HWIO_LPASS_LPAIF_RDDMA_SET_BUFF_CNT0_ADDR A:0x7710420
y.create.l HWIO_LPASS_LPAIF_RDDMA_SET_BUFF_CNT1_ADDR A:0x7711420
y.create.l HWIO_LPASS_LPAIF_RDDMA_SET_PER_CNT0_ADDR A:0x7710424
y.create.l HWIO_LPASS_LPAIF_RDDMA_SET_PER_CNT1_ADDR A:0x7711424
y.create.l HWIO_LPASS_LPAIF_RDDMA_STC_LSB0_ADDR A:0x7710428
y.create.l HWIO_LPASS_LPAIF_RDDMA_STC_LSB1_ADDR A:0x7711428
y.create.l HWIO_LPASS_LPAIF_RDDMA_STC_MSB0_ADDR A:0x771042c
y.create.l HWIO_LPASS_LPAIF_RDDMA_STC_MSB1_ADDR A:0x771142c
y.create.l HWIO_LPASS_LPAIF_RDDMA_PER0_ADDR A:0x7710430
y.create.l HWIO_LPASS_LPAIF_RDDMA_PER1_ADDR A:0x7711430
y.create.l HWIO_LPASS_LPAIF_RDDMA_PERCLR0_ADDR A:0x7710434
y.create.l HWIO_LPASS_LPAIF_RDDMA_PERCLR1_ADDR A:0x7711434
y.create.l HWIO_LPASS_LPAIF_RDDMA_BASE_EXT0_ADDR A:0x7710438
y.create.l HWIO_LPASS_LPAIF_RDDMA_BASE_EXT1_ADDR A:0x7711438
y.create.l HWIO_LPASS_LPAIF_RDDMA_CURR_ADDR_EXT0_ADDR A:0x771043c
y.create.l HWIO_LPASS_LPAIF_RDDMA_CURR_ADDR_EXT1_ADDR A:0x771143c
y.create.l HWIO_LPASS_LPAIF_WRDMA_CTL0_ADDR A:0x7713000
y.create.l HWIO_LPASS_LPAIF_WRDMA_CTL1_ADDR A:0x7714000
y.create.l HWIO_LPASS_LPAIF_WRDMA_BASE0_ADDR A:0x7713004
y.create.l HWIO_LPASS_LPAIF_WRDMA_BASE1_ADDR A:0x7714004
y.create.l HWIO_LPASS_LPAIF_WRDMA_BUFF_LEN0_ADDR A:0x7713008
y.create.l HWIO_LPASS_LPAIF_WRDMA_BUFF_LEN1_ADDR A:0x7714008
y.create.l HWIO_LPASS_LPAIF_WRDMA_CURR_ADDR0_ADDR A:0x771300c
y.create.l HWIO_LPASS_LPAIF_WRDMA_CURR_ADDR1_ADDR A:0x771400c
y.create.l HWIO_LPASS_LPAIF_WRDMA_PER_LEN0_ADDR A:0x7713010
y.create.l HWIO_LPASS_LPAIF_WRDMA_PER_LEN1_ADDR A:0x7714010
y.create.l HWIO_LPASS_LPAIF_WRDMA_PER_CNT0_ADDR A:0x7713014
y.create.l HWIO_LPASS_LPAIF_WRDMA_PER_CNT1_ADDR A:0x7714014
y.create.l HWIO_LPASS_LPAIF_WRDMA_FRM0_ADDR A:0x7713018
y.create.l HWIO_LPASS_LPAIF_WRDMA_FRM1_ADDR A:0x7714018
y.create.l HWIO_LPASS_LPAIF_WRDMA_FRMCLR0_ADDR A:0x771301c
y.create.l HWIO_LPASS_LPAIF_WRDMA_FRMCLR1_ADDR A:0x771401c
y.create.l HWIO_LPASS_LPAIF_WRDMA_SET_BUFF_CNT0_ADDR A:0x7713020
y.create.l HWIO_LPASS_LPAIF_WRDMA_SET_BUFF_CNT1_ADDR A:0x7714020
y.create.l HWIO_LPASS_LPAIF_WRDMA_SET_PER_CNT0_ADDR A:0x7713024
y.create.l HWIO_LPASS_LPAIF_WRDMA_SET_PER_CNT1_ADDR A:0x7714024
y.create.l HWIO_LPASS_LPAIF_WRDMA_STC_LSB0_ADDR A:0x7713028
y.create.l HWIO_LPASS_LPAIF_WRDMA_STC_LSB1_ADDR A:0x7714028
y.create.l HWIO_LPASS_LPAIF_WRDMA_STC_MSB0_ADDR A:0x771302c
y.create.l HWIO_LPASS_LPAIF_WRDMA_STC_MSB1_ADDR A:0x771402c
y.create.l HWIO_LPASS_LPAIF_WRDMA_PER0_ADDR A:0x7713030
y.create.l HWIO_LPASS_LPAIF_WRDMA_PER1_ADDR A:0x7714030
y.create.l HWIO_LPASS_LPAIF_WRDMA_PERCLR0_ADDR A:0x7713034
y.create.l HWIO_LPASS_LPAIF_WRDMA_PERCLR1_ADDR A:0x7714034
y.create.l HWIO_LPASS_LPAIF_WRDMA_BASE_EXT0_ADDR A:0x7713038
y.create.l HWIO_LPASS_LPAIF_WRDMA_BASE_EXT1_ADDR A:0x7714038
y.create.l HWIO_LPASS_LPAIF_WRDMA_CURR_ADDR_EXT0_ADDR A:0x771303c
y.create.l HWIO_LPASS_LPAIF_WRDMA_CURR_ADDR_EXT1_ADDR A:0x771403c
y.create.l HWIO_LPASS_CDC_CLK_RX_RESET_CTL_ADDR A:0x771c000
y.create.l HWIO_LPASS_CDC_CLK_TX_RESET_B1_CTL_ADDR A:0x771c004
y.create.l HWIO_LPASS_CDC_CLK_DMIC_B1_CTL_ADDR A:0x771c008
y.create.l HWIO_LPASS_CDC_CLK_RX_I2S_CTL_ADDR A:0x771c00c
y.create.l HWIO_LPASS_CDC_CLK_TX_I2S_CTL_ADDR A:0x771c010
y.create.l HWIO_LPASS_CDC_CLK_OTHR_RESET_B1_CTL_ADDR A:0x771c014
y.create.l HWIO_LPASS_CDC_CLK_TX_CLK_EN_B1_CTL_ADDR A:0x771c018
y.create.l HWIO_LPASS_CDC_CLK_OTHR_CTL_ADDR A:0x771c01c
y.create.l HWIO_LPASS_CDC_CLK_RX_B1_CTL_ADDR A:0x771c020
y.create.l HWIO_LPASS_CDC_CLK_MCLK_CTL_ADDR A:0x771c024
y.create.l HWIO_LPASS_CDC_CLK_PDM_CTL_ADDR A:0x771c028
y.create.l HWIO_LPASS_CDC_CLK_SD_CTL_ADDR A:0x771c02c
y.create.l HWIO_LPASS_CDC_RX1_B1_CTL_ADDR A:0x771c040
y.create.l HWIO_LPASS_CDC_RX2_B1_CTL_ADDR A:0x771c060
y.create.l HWIO_LPASS_CDC_RX3_B1_CTL_ADDR A:0x771c080
y.create.l HWIO_LPASS_CDC_RX1_B2_CTL_ADDR A:0x771c044
y.create.l HWIO_LPASS_CDC_RX2_B2_CTL_ADDR A:0x771c064
y.create.l HWIO_LPASS_CDC_RX3_B2_CTL_ADDR A:0x771c084
y.create.l HWIO_LPASS_CDC_RX1_B3_CTL_ADDR A:0x771c048
y.create.l HWIO_LPASS_CDC_RX2_B3_CTL_ADDR A:0x771c068
y.create.l HWIO_LPASS_CDC_RX3_B3_CTL_ADDR A:0x771c088
y.create.l HWIO_LPASS_CDC_RX1_B4_CTL_ADDR A:0x771c04c
y.create.l HWIO_LPASS_CDC_RX2_B4_CTL_ADDR A:0x771c06c
y.create.l HWIO_LPASS_CDC_RX3_B4_CTL_ADDR A:0x771c08c
y.create.l HWIO_LPASS_CDC_RX1_B5_CTL_ADDR A:0x771c050
y.create.l HWIO_LPASS_CDC_RX2_B5_CTL_ADDR A:0x771c070
y.create.l HWIO_LPASS_CDC_RX3_B5_CTL_ADDR A:0x771c090
y.create.l HWIO_LPASS_CDC_RX1_B6_CTL_ADDR A:0x771c054
y.create.l HWIO_LPASS_CDC_RX2_B6_CTL_ADDR A:0x771c074
y.create.l HWIO_LPASS_CDC_RX3_B6_CTL_ADDR A:0x771c094
y.create.l HWIO_LPASS_CDC_RX1_VOL_CTL_B1_CTL_ADDR A:0x771c058
y.create.l HWIO_LPASS_CDC_RX2_VOL_CTL_B1_CTL_ADDR A:0x771c078
y.create.l HWIO_LPASS_CDC_RX3_VOL_CTL_B1_CTL_ADDR A:0x771c098
y.create.l HWIO_LPASS_CDC_RX1_VOL_CTL_B2_CTL_ADDR A:0x771c05c
y.create.l HWIO_LPASS_CDC_RX2_VOL_CTL_B2_CTL_ADDR A:0x771c07c
y.create.l HWIO_LPASS_CDC_RX3_VOL_CTL_B2_CTL_ADDR A:0x771c09c
y.create.l HWIO_LPASS_CDC_TOP_GAIN_UPDATE_ADDR A:0x771c0a0
y.create.l HWIO_LPASS_CDC_TOP_CTL_ADDR A:0x771c0a4
y.create.l HWIO_LPASS_CDC_DEBUG_DESER1_CTL_ADDR A:0x771c0e0
y.create.l HWIO_LPASS_CDC_DEBUG_DESER2_CTL_ADDR A:0x771c0e4
y.create.l HWIO_LPASS_CDC_DEBUG_B1_CTL_ADDR A:0x771c0e8
y.create.l HWIO_LPASS_CDC_DEBUG_B2_CTL_ADDR A:0x771c0ec
y.create.l HWIO_LPASS_CDC_DEBUG_B3_CTL_ADDR A:0x771c0f0
y.create.l HWIO_LPASS_CDC_IIR1_GAIN_B1_CTL_ADDR A:0x771c100
y.create.l HWIO_LPASS_CDC_IIR2_GAIN_B1_CTL_ADDR A:0x771c140
y.create.l HWIO_LPASS_CDC_IIR1_GAIN_B2_CTL_ADDR A:0x771c104
y.create.l HWIO_LPASS_CDC_IIR2_GAIN_B2_CTL_ADDR A:0x771c144
y.create.l HWIO_LPASS_CDC_IIR1_GAIN_B3_CTL_ADDR A:0x771c108
y.create.l HWIO_LPASS_CDC_IIR2_GAIN_B3_CTL_ADDR A:0x771c148
y.create.l HWIO_LPASS_CDC_IIR1_GAIN_B4_CTL_ADDR A:0x771c10c
y.create.l HWIO_LPASS_CDC_IIR2_GAIN_B4_CTL_ADDR A:0x771c14c
y.create.l HWIO_LPASS_CDC_IIR1_GAIN_B5_CTL_ADDR A:0x771c110
y.create.l HWIO_LPASS_CDC_IIR2_GAIN_B5_CTL_ADDR A:0x771c150
y.create.l HWIO_LPASS_CDC_IIR1_GAIN_B6_CTL_ADDR A:0x771c114
y.create.l HWIO_LPASS_CDC_IIR2_GAIN_B6_CTL_ADDR A:0x771c154
y.create.l HWIO_LPASS_CDC_IIR1_GAIN_B7_CTL_ADDR A:0x771c118
y.create.l HWIO_LPASS_CDC_IIR2_GAIN_B7_CTL_ADDR A:0x771c158
y.create.l HWIO_LPASS_CDC_IIR1_GAIN_B8_CTL_ADDR A:0x771c11c
y.create.l HWIO_LPASS_CDC_IIR2_GAIN_B8_CTL_ADDR A:0x771c15c
y.create.l HWIO_LPASS_CDC_IIR1_CTL_ADDR A:0x771c120
y.create.l HWIO_LPASS_CDC_IIR2_CTL_ADDR A:0x771c160
y.create.l HWIO_LPASS_CDC_IIR1_GAIN_TIMER_CTL_ADDR A:0x771c124
y.create.l HWIO_LPASS_CDC_IIR2_GAIN_TIMER_CTL_ADDR A:0x771c164
y.create.l HWIO_LPASS_CDC_IIR1_COEF_B1_CTL_ADDR A:0x771c128
y.create.l HWIO_LPASS_CDC_IIR2_COEF_B1_CTL_ADDR A:0x771c168
y.create.l HWIO_LPASS_CDC_IIR1_COEF_B2_CTL_ADDR A:0x771c12c
y.create.l HWIO_LPASS_CDC_IIR2_COEF_B2_CTL_ADDR A:0x771c16c
y.create.l HWIO_LPASS_CDC_CONN_RX1_B1_CTL_ADDR A:0x771c180
y.create.l HWIO_LPASS_CDC_CONN_RX1_B2_CTL_ADDR A:0x771c184
y.create.l HWIO_LPASS_CDC_CONN_RX1_B3_CTL_ADDR A:0x771c188
y.create.l HWIO_LPASS_CDC_CONN_RX2_B1_CTL_ADDR A:0x771c18c
y.create.l HWIO_LPASS_CDC_CONN_RX2_B2_CTL_ADDR A:0x771c190
y.create.l HWIO_LPASS_CDC_CONN_RX2_B3_CTL_ADDR A:0x771c194
y.create.l HWIO_LPASS_CDC_CONN_RX3_B1_CTL_ADDR A:0x771c198
y.create.l HWIO_LPASS_CDC_CONN_RX3_B2_CTL_ADDR A:0x771c19c
y.create.l HWIO_LPASS_CDC_CONN_TX_B1_CTL_ADDR A:0x771c1a0
y.create.l HWIO_LPASS_CDC_CONN_EQ1_B1_CTL_ADDR A:0x771c1a8
y.create.l HWIO_LPASS_CDC_CONN_EQ1_B2_CTL_ADDR A:0x771c1ac
y.create.l HWIO_LPASS_CDC_CONN_EQ1_B3_CTL_ADDR A:0x771c1b0
y.create.l HWIO_LPASS_CDC_CONN_EQ1_B4_CTL_ADDR A:0x771c1b4
y.create.l HWIO_LPASS_CDC_CONN_EQ2_B1_CTL_ADDR A:0x771c1b8
y.create.l HWIO_LPASS_CDC_CONN_EQ2_B2_CTL_ADDR A:0x771c1bc
y.create.l HWIO_LPASS_CDC_CONN_EQ2_B3_CTL_ADDR A:0x771c1c0
y.create.l HWIO_LPASS_CDC_CONN_EQ2_B4_CTL_ADDR A:0x771c1c4
y.create.l HWIO_LPASS_CDC_CONN_TX_I2S_SD1_CTL_ADDR A:0x771c1c8
y.create.l HWIO_LPASS_CDC_TX1_VOL_CTL_TIMER_ADDR A:0x771c280
y.create.l HWIO_LPASS_CDC_TX2_VOL_CTL_TIMER_ADDR A:0x771c2a0
y.create.l HWIO_LPASS_CDC_TX1_VOL_CTL_GAIN_ADDR A:0x771c284
y.create.l HWIO_LPASS_CDC_TX2_VOL_CTL_GAIN_ADDR A:0x771c2a4
y.create.l HWIO_LPASS_CDC_TX1_VOL_CTL_CFG_ADDR A:0x771c288
y.create.l HWIO_LPASS_CDC_TX2_VOL_CTL_CFG_ADDR A:0x771c2a8
y.create.l HWIO_LPASS_CDC_TX1_MUX_CTL_ADDR A:0x771c28c
y.create.l HWIO_LPASS_CDC_TX2_MUX_CTL_ADDR A:0x771c2ac
y.create.l HWIO_LPASS_CDC_TX1_CLK_FS_CTL_ADDR A:0x771c290
y.create.l HWIO_LPASS_CDC_TX2_CLK_FS_CTL_ADDR A:0x771c2b0
y.create.l HWIO_LPASS_CDC_TX1_DMIC_CTL_ADDR A:0x771c294
y.create.l HWIO_LPASS_CDC_TX2_DMIC_CTL_ADDR A:0x771c2b4
y.create.l HWIO_USB2_HSIC_USB_OTG_HS_ID_ADDR A:0x78d9000
y.create.l HWIO_USB2_HSIC_USB_OTG_HS_HWGENERAL_ADDR A:0x78d9004
y.create.l HWIO_USB2_HSIC_USB_OTG_HS_HWHOST_ADDR A:0x78d9008
y.create.l HWIO_USB2_HSIC_USB_OTG_HS_HWDEVICE_ADDR A:0x78d900c
y.create.l HWIO_USB2_HSIC_USB_OTG_HS_HWTXBUF_ADDR A:0x78d9010
y.create.l HWIO_USB2_HSIC_USB_OTG_HS_HWRXBUF_ADDR A:0x78d9014
y.create.l HWIO_USB2_HSIC_USB_OTG_HS_SCRATCH_RAM0_ADDR A:0x78d9040
y.create.l HWIO_USB2_HSIC_USB_OTG_HS_SCRATCH_RAM1_ADDR A:0x78d9044
y.create.l HWIO_USB2_HSIC_USB_OTG_HS_SCRATCH_RAM2_ADDR A:0x78d9048
y.create.l HWIO_USB2_HSIC_USB_OTG_HS_SCRATCH_RAM3_ADDR A:0x78d904c
y.create.l HWIO_USB2_HSIC_USB_OTG_HS_SCRATCH_RAM4_ADDR A:0x78d9050
y.create.l HWIO_USB2_HSIC_USB_OTG_HS_SCRATCH_RAM5_ADDR A:0x78d9054
y.create.l HWIO_USB2_HSIC_USB_OTG_HS_SCRATCH_RAM6_ADDR A:0x78d9058
y.create.l HWIO_USB2_HSIC_USB_OTG_HS_SCRATCH_RAM7_ADDR A:0x78d905c
y.create.l HWIO_USB2_HSIC_USB_OTG_HS_SCRATCH_RAM8_ADDR A:0x78d9060
y.create.l HWIO_USB2_HSIC_USB_OTG_HS_SCRATCH_RAM9_ADDR A:0x78d9064
y.create.l HWIO_USB2_HSIC_USB_OTG_HS_GPTIMER0LD_ADDR A:0x78d9080
y.create.l HWIO_USB2_HSIC_USB_OTG_HS_GPTIMER0CTRL_ADDR A:0x78d9084
y.create.l HWIO_USB2_HSIC_USB_OTG_HS_GPTIMER1LD_ADDR A:0x78d9088
y.create.l HWIO_USB2_HSIC_USB_OTG_HS_GPTIMER1CTRL_ADDR A:0x78d908c
y.create.l HWIO_USB2_HSIC_USB_OTG_HS_AHB_BURST_ADDR A:0x78d9090
y.create.l HWIO_USB2_HSIC_USB_OTG_HS_XTOR_STS_ADDR A:0x78d9094
y.create.l HWIO_USB2_HSIC_USB_OTG_HS_AHB_MODE_ADDR A:0x78d9098
y.create.l HWIO_USB2_HSIC_USB_OTG_HS_GEN_CONFIG_ADDR A:0x78d909c
y.create.l HWIO_USB2_HSIC_USB_OTG_HS_GEN_CONFIG_2_ADDR A:0x78d90a0
y.create.l HWIO_USB2_HSIC_USB_OTG_HS_CAPLENGTH_ADDR A:0x78d9100
y.create.l HWIO_USB2_HSIC_USB_OTG_HS_HCSPARAMS_ADDR A:0x78d9104
y.create.l HWIO_USB2_HSIC_USB_OTG_HS_HCCPARAMS_ADDR A:0x78d9108
y.create.l HWIO_USB2_HSIC_USB_OTG_HS_DCIVERSION_ADDR A:0x78d9120
y.create.l HWIO_USB2_HSIC_USB_OTG_HS_DCCPARAMS_ADDR A:0x78d9124
y.create.l HWIO_USB2_HSIC_USB_OTG_HS_USBCMD_ADDR A:0x78d9140
y.create.l HWIO_USB2_HSIC_USB_OTG_HS_USBSTS_ADDR A:0x78d9144
y.create.l HWIO_USB2_HSIC_USB_OTG_HS_USBINTR_ADDR A:0x78d9148
y.create.l HWIO_USB2_HSIC_USB_OTG_HS_FRINDEX_ADDR A:0x78d914c
y.create.l HWIO_USB2_HSIC_USB_OTG_HS_PERIODICLISTBASE_ADDR A:0x78d9154
y.create.l HWIO_USB2_HSIC_USB_OTG_HS_DEVICEADDR_ADDR A:0x78d9154
y.create.l HWIO_USB2_HSIC_USB_OTG_HS_ASYNCLISTADDR_ADDR A:0x78d9158
y.create.l HWIO_USB2_HSIC_USB_OTG_HS_ENDPOINTLISTADDR_ADDR A:0x78d9158
y.create.l HWIO_USB2_HSIC_USB_OTG_HS_TTCTRL_ADDR A:0x78d915c
y.create.l HWIO_USB2_HSIC_USB_OTG_HS_BURSTSIZE_ADDR A:0x78d9160
y.create.l HWIO_USB2_HSIC_USB_OTG_HS_TXFILLTUNING_ADDR A:0x78d9164
y.create.l HWIO_USB2_HSIC_USB_OTG_HS_ULPI_VIEWPORT_ADDR A:0x78d9170
y.create.l HWIO_USB2_HSIC_USB_OTG_HS_ENDPTNAK_ADDR A:0x78d9178
y.create.l HWIO_USB2_HSIC_USB_OTG_HS_ENDPTNAKEN_ADDR A:0x78d917c
y.create.l HWIO_USB2_HSIC_USB_OTG_HS_PORTSC_ADDR A:0x78d9184
y.create.l HWIO_USB2_HSIC_USB_OTG_HS_OTGSC_ADDR A:0x78d91a4
y.create.l HWIO_USB2_HSIC_USB_OTG_HS_USBMODE_ADDR A:0x78d91a8
y.create.l HWIO_USB2_HSIC_USB_OTG_HS_ENDPTSETUPSTAT_ADDR A:0x78d91ac
y.create.l HWIO_USB2_HSIC_USB_OTG_HS_ENDPTPRIME_ADDR A:0x78d91b0
y.create.l HWIO_USB2_HSIC_USB_OTG_HS_ENDPTFLUSH_ADDR A:0x78d91b4
y.create.l HWIO_USB2_HSIC_USB_OTG_HS_ENDPTSTAT_ADDR A:0x78d91b8
y.create.l HWIO_USB2_HSIC_USB_OTG_HS_ENDPTCOMPLETE_ADDR A:0x78d91bc
y.create.l HWIO_USB2_HSIC_USB_OTG_HS_ENDPTCTRL0_ADDR A:0x78d91c0
y.create.l HWIO_USB2_HSIC_USB_OTG_HS_ENDPTCTRL1_ADDR A:0x78d91c4
y.create.l HWIO_USB2_HSIC_USB_OTG_HS_ENDPTCTRL2_ADDR A:0x78d91c8
y.create.l HWIO_USB2_HSIC_USB_OTG_HS_ENDPTCTRL3_ADDR A:0x78d91cc
y.create.l HWIO_USB2_HSIC_USB_OTG_HS_ENDPTCTRL4_ADDR A:0x78d91d0
y.create.l HWIO_USB2_HSIC_USB_OTG_HS_ENDPTCTRL5_ADDR A:0x78d91d4
y.create.l HWIO_USB2_HSIC_USB_OTG_HS_ENDPTCTRL6_ADDR A:0x78d91d8
y.create.l HWIO_USB2_HSIC_USB_OTG_HS_ENDPTCTRL7_ADDR A:0x78d91dc
y.create.l HWIO_USB2_HSIC_USB_OTG_HS_ENDPTCTRL8_ADDR A:0x78d91e0
y.create.l HWIO_USB2_HSIC_USB_OTG_HS_ENDPTCTRL9_ADDR A:0x78d91e4
y.create.l HWIO_USB2_HSIC_USB_OTG_HS_ENDPTCTRL10_ADDR A:0x78d91e8
y.create.l HWIO_USB2_HSIC_USB_OTG_HS_ENDPT_PIPE_ID1_ADDR A:0x78d9200
y.create.l HWIO_USB2_HSIC_USB_OTG_HS_ENDPT_PIPE_ID2_ADDR A:0x78d9204
y.create.l HWIO_USB2_HSIC_USB_OTG_HS_ENDPT_PIPE_ID3_ADDR A:0x78d9208
y.create.l HWIO_USB2_HSIC_USB_OTG_HS_ENDPT_PIPE_ID4_ADDR A:0x78d920c
y.create.l HWIO_USB2_HSIC_USB_OTG_HS_ENDPT_PIPE_ID5_ADDR A:0x78d9210
y.create.l HWIO_USB2_HSIC_USB_OTG_HS_ENDPT_PIPE_ID6_ADDR A:0x78d9214
y.create.l HWIO_USB2_HSIC_USB_OTG_HS_ENDPT_PIPE_ID7_ADDR A:0x78d9218
y.create.l HWIO_USB2_HSIC_USB_OTG_HS_ENDPT_PIPE_ID8_ADDR A:0x78d921c
y.create.l HWIO_USB2_HSIC_USB_OTG_HS_ENDPT_PIPE_ID9_ADDR A:0x78d9220
y.create.l HWIO_USB2_HSIC_USB_OTG_HS_ENDPT_PIPE_ID10_ADDR A:0x78d9224
y.create.l HWIO_USB2_HSIC_USB_OTG_HS_PHY_CTRL_ADDR A:0x78d9240
y.create.l HWIO_USB2_HSIC_USB_OTG_HS_GENERIC1_ADDR A:0x78d9244
y.create.l HWIO_USB2_HSIC_USB_OTG_HS_GENERIC2_ADDR A:0x78d9248
y.create.l HWIO_USB2_HSIC_USB_OTG_HS_L1_EP_CTRL_ADDR A:0x78d9250
y.create.l HWIO_USB2_HSIC_USB_OTG_HS_L1_CONFIG_ADDR A:0x78d9254
y.create.l HWIO_USB2_HSIC_USB_OTG_HS_LPM_DEBUG_1_ADDR A:0x78d9258
y.create.l HWIO_USB2_HSIC_USB_OTG_HS_LPM_DEBUG_2_ADDR A:0x78d925c
y.create.l HWIO_USB2_HSIC_USB_OTG_HS_LPM_ATTRIBUTES_ADDR A:0x78d9260
y.create.l HWIO_USB2_HSIC_USB_OTG_HS_LPM_TIMERS_ADDR A:0x78d9264
y.create.l HWIO_USB2_HSIC_USB_OTG_HS_HW_VER_ADDR A:0x78d9270
y.create.l HWIO_USB2_HSIC_USB_OTG_HS_TEST_BUS_ADDR A:0x78d9274
y.create.l HWIO_USB2_HSIC_USB_OTG_HS_PHY_SEC_CTRL_ADDR A:0x78d9278
y.create.l HWIO_USB2_HSIC_USB_OTG_HS_BTO_TIME_HS_ADDR A:0x78d9340
y.create.l HWIO_USB2_HSIC_USB_OTG_HS_BTO_TIME_FS_LS_ADDR A:0x78d9344
y.create.l HWIO_USB2_HSIC_USB_OTG_HS_QSB_VALUES_ADDR A:0x78d9348
y.create.l HWIO_USB2_HSIC_USB_OTG_HS_BAM_CTRL_ADDR A:0x78c4000
y.create.l HWIO_USB2_HSIC_USB_OTG_HS_BAM_TIMER_ADDR A:0x78c4040
y.create.l HWIO_USB2_HSIC_USB_OTG_HS_BAM_TIMER_CTRL_ADDR A:0x78c4044
y.create.l HWIO_USB2_HSIC_USB_OTG_HS_BAM_DESC_CNT_TRSHLD_ADDR A:0x78c4008
y.create.l HWIO_USB2_HSIC_USB_OTG_HS_BAM_IRQ_STTS_ADDR A:0x78c4014
y.create.l HWIO_USB2_HSIC_USB_OTG_HS_BAM_IRQ_CLR_ADDR A:0x78c4018
y.create.l HWIO_USB2_HSIC_USB_OTG_HS_BAM_IRQ_EN_ADDR A:0x78c401c
y.create.l HWIO_USB2_HSIC_USB_OTG_HS_BAM_CNFG_BITS_ADDR A:0x78c407c
y.create.l HWIO_USB2_HSIC_USB_OTG_HS_BAM_REVISION_ADDR A:0x78c5000
y.create.l HWIO_USB2_HSIC_USB_OTG_HS_BAM_SW_VERSION_ADDR A:0x78c5004
y.create.l HWIO_USB2_HSIC_USB_OTG_HS_BAM_NUM_PIPES_ADDR A:0x78c5008
y.create.l HWIO_USB2_HSIC_USB_OTG_HS_BAM_TEST_BUS_SEL_ADDR A:0x78c5010
y.create.l HWIO_USB2_HSIC_USB_OTG_HS_BAM_TEST_BUS_REG_ADDR A:0x78c5014
y.create.l HWIO_USB2_HSIC_USB_OTG_HS_BAM_AHB_MASTER_ERR_CTRLS_ADDR A:0x78c5024
y.create.l HWIO_USB2_HSIC_USB_OTG_HS_BAM_AHB_MASTER_ERR_ADDR_ADDR A:0x78c5028
y.create.l HWIO_USB2_HSIC_USB_OTG_HS_BAM_AHB_MASTER_ERR_DATA_ADDR A:0x78c502c
y.create.l HWIO_USB2_HSIC_USB_OTG_HS_BAM_AHB_MASTER_ERR_ADDR_LSB_ADDR A:0x78c5100
y.create.l HWIO_USB2_HSIC_USB_OTG_HS_BAM_AHB_MASTER_ERR_ADDR_MSB_ADDR A:0x78c5104
y.create.l HWIO_USB2_HSIC_USB_OTG_HS_BAM_TRUST_REG_ADDR A:0x78c6000
y.create.l HWIO_USB2_HSIC_USB_OTG_HS_BAM_P_TRUST_REG0_ADDR A:0x78c6020
y.create.l HWIO_USB2_HSIC_USB_OTG_HS_BAM_P_TRUST_REG1_ADDR A:0x78c6024
y.create.l HWIO_USB2_HSIC_USB_OTG_HS_BAM_IRQ_SRCS_EE0_ADDR A:0x78c7000
y.create.l HWIO_USB2_HSIC_USB_OTG_HS_BAM_IRQ_SRCS_EE1_ADDR A:0x78c8000
y.create.l HWIO_USB2_HSIC_USB_OTG_HS_BAM_IRQ_SRCS_EE2_ADDR A:0x78c9000
y.create.l HWIO_USB2_HSIC_USB_OTG_HS_BAM_IRQ_SRCS_EE3_ADDR A:0x78ca000
y.create.l HWIO_USB2_HSIC_USB_OTG_HS_BAM_IRQ_SRCS_EE4_ADDR A:0x78cb000
y.create.l HWIO_USB2_HSIC_USB_OTG_HS_BAM_IRQ_SRCS_EE5_ADDR A:0x78cc000
y.create.l HWIO_USB2_HSIC_USB_OTG_HS_BAM_IRQ_SRCS_EE6_ADDR A:0x78cd000
y.create.l HWIO_USB2_HSIC_USB_OTG_HS_BAM_IRQ_SRCS_EE7_ADDR A:0x78ce000
y.create.l HWIO_USB2_HSIC_USB_OTG_HS_BAM_IRQ_SRCS_MSK_EE0_ADDR A:0x78c7004
y.create.l HWIO_USB2_HSIC_USB_OTG_HS_BAM_IRQ_SRCS_MSK_EE1_ADDR A:0x78c8004
y.create.l HWIO_USB2_HSIC_USB_OTG_HS_BAM_IRQ_SRCS_MSK_EE2_ADDR A:0x78c9004
y.create.l HWIO_USB2_HSIC_USB_OTG_HS_BAM_IRQ_SRCS_MSK_EE3_ADDR A:0x78ca004
y.create.l HWIO_USB2_HSIC_USB_OTG_HS_BAM_IRQ_SRCS_MSK_EE4_ADDR A:0x78cb004
y.create.l HWIO_USB2_HSIC_USB_OTG_HS_BAM_IRQ_SRCS_MSK_EE5_ADDR A:0x78cc004
y.create.l HWIO_USB2_HSIC_USB_OTG_HS_BAM_IRQ_SRCS_MSK_EE6_ADDR A:0x78cd004
y.create.l HWIO_USB2_HSIC_USB_OTG_HS_BAM_IRQ_SRCS_MSK_EE7_ADDR A:0x78ce004
y.create.l HWIO_USB2_HSIC_USB_OTG_HS_BAM_IRQ_SRCS_UNMASKED_EE0_ADDR A:0x78c7008
y.create.l HWIO_USB2_HSIC_USB_OTG_HS_BAM_IRQ_SRCS_UNMASKED_EE1_ADDR A:0x78c8008
y.create.l HWIO_USB2_HSIC_USB_OTG_HS_BAM_IRQ_SRCS_UNMASKED_EE2_ADDR A:0x78c9008
y.create.l HWIO_USB2_HSIC_USB_OTG_HS_BAM_IRQ_SRCS_UNMASKED_EE3_ADDR A:0x78ca008
y.create.l HWIO_USB2_HSIC_USB_OTG_HS_BAM_IRQ_SRCS_UNMASKED_EE4_ADDR A:0x78cb008
y.create.l HWIO_USB2_HSIC_USB_OTG_HS_BAM_IRQ_SRCS_UNMASKED_EE5_ADDR A:0x78cc008
y.create.l HWIO_USB2_HSIC_USB_OTG_HS_BAM_IRQ_SRCS_UNMASKED_EE6_ADDR A:0x78cd008
y.create.l HWIO_USB2_HSIC_USB_OTG_HS_BAM_IRQ_SRCS_UNMASKED_EE7_ADDR A:0x78ce008
y.create.l HWIO_USB2_HSIC_USB_OTG_HS_BAM_PIPE_ATTR_EE0_ADDR A:0x78c700c
y.create.l HWIO_USB2_HSIC_USB_OTG_HS_BAM_PIPE_ATTR_EE1_ADDR A:0x78c800c
y.create.l HWIO_USB2_HSIC_USB_OTG_HS_BAM_PIPE_ATTR_EE2_ADDR A:0x78c900c
y.create.l HWIO_USB2_HSIC_USB_OTG_HS_BAM_PIPE_ATTR_EE3_ADDR A:0x78ca00c
y.create.l HWIO_USB2_HSIC_USB_OTG_HS_BAM_PIPE_ATTR_EE4_ADDR A:0x78cb00c
y.create.l HWIO_USB2_HSIC_USB_OTG_HS_BAM_PIPE_ATTR_EE5_ADDR A:0x78cc00c
y.create.l HWIO_USB2_HSIC_USB_OTG_HS_BAM_PIPE_ATTR_EE6_ADDR A:0x78cd00c
y.create.l HWIO_USB2_HSIC_USB_OTG_HS_BAM_PIPE_ATTR_EE7_ADDR A:0x78ce00c
y.create.l HWIO_USB2_HSIC_USB_OTG_HS_BAM_IRQ_SRCS_ADDR A:0x78c7010
y.create.l HWIO_USB2_HSIC_USB_OTG_HS_BAM_IRQ_SRCS_MSK_ADDR A:0x78c7014
y.create.l HWIO_USB2_HSIC_USB_OTG_HS_BAM_IRQ_SRCS_UNMASKED_ADDR A:0x78c7018
y.create.l HWIO_USB2_HSIC_USB_OTG_HS_BAM_P_CTRL0_ADDR A:0x78d7000
y.create.l HWIO_USB2_HSIC_USB_OTG_HS_BAM_P_CTRL1_ADDR A:0x78d8000
y.create.l HWIO_USB2_HSIC_USB_OTG_HS_BAM_P_RST0_ADDR A:0x78d7004
y.create.l HWIO_USB2_HSIC_USB_OTG_HS_BAM_P_RST1_ADDR A:0x78d8004
y.create.l HWIO_USB2_HSIC_USB_OTG_HS_BAM_P_HALT0_ADDR A:0x78d7008
y.create.l HWIO_USB2_HSIC_USB_OTG_HS_BAM_P_HALT1_ADDR A:0x78d8008
y.create.l HWIO_USB2_HSIC_USB_OTG_HS_BAM_P_IRQ_STTS0_ADDR A:0x78d7010
y.create.l HWIO_USB2_HSIC_USB_OTG_HS_BAM_P_IRQ_STTS1_ADDR A:0x78d8010
y.create.l HWIO_USB2_HSIC_USB_OTG_HS_BAM_P_IRQ_CLR0_ADDR A:0x78d7014
y.create.l HWIO_USB2_HSIC_USB_OTG_HS_BAM_P_IRQ_CLR1_ADDR A:0x78d8014
y.create.l HWIO_USB2_HSIC_USB_OTG_HS_BAM_P_IRQ_EN0_ADDR A:0x78d7018
y.create.l HWIO_USB2_HSIC_USB_OTG_HS_BAM_P_IRQ_EN1_ADDR A:0x78d8018
y.create.l HWIO_USB2_HSIC_USB_OTG_HS_BAM_P_TIMER0_ADDR A:0x78d701c
y.create.l HWIO_USB2_HSIC_USB_OTG_HS_BAM_P_TIMER1_ADDR A:0x78d801c
y.create.l HWIO_USB2_HSIC_USB_OTG_HS_BAM_P_TIMER_CTRL0_ADDR A:0x78d7020
y.create.l HWIO_USB2_HSIC_USB_OTG_HS_BAM_P_TIMER_CTRL1_ADDR A:0x78d8020
y.create.l HWIO_USB2_HSIC_USB_OTG_HS_BAM_P_PRDCR_SDBND0_ADDR A:0x78d7024
y.create.l HWIO_USB2_HSIC_USB_OTG_HS_BAM_P_PRDCR_SDBND1_ADDR A:0x78d8024
y.create.l HWIO_USB2_HSIC_USB_OTG_HS_BAM_P_CNSMR_SDBND0_ADDR A:0x78d7028
y.create.l HWIO_USB2_HSIC_USB_OTG_HS_BAM_P_CNSMR_SDBND1_ADDR A:0x78d8028
y.create.l HWIO_USB2_HSIC_USB_OTG_HS_BAM_P_SW_OFSTS0_ADDR A:0x78d7800
y.create.l HWIO_USB2_HSIC_USB_OTG_HS_BAM_P_SW_OFSTS1_ADDR A:0x78d8800
y.create.l HWIO_USB2_HSIC_USB_OTG_HS_BAM_P_AU_PSM_CNTXT_1_0_ADDR A:0x78d7804
y.create.l HWIO_USB2_HSIC_USB_OTG_HS_BAM_P_AU_PSM_CNTXT_1_1_ADDR A:0x78d8804
y.create.l HWIO_USB2_HSIC_USB_OTG_HS_BAM_P_PSM_CNTXT_2_0_ADDR A:0x78d7808
y.create.l HWIO_USB2_HSIC_USB_OTG_HS_BAM_P_PSM_CNTXT_2_1_ADDR A:0x78d8808
y.create.l HWIO_USB2_HSIC_USB_OTG_HS_BAM_P_PSM_CNTXT_3_0_ADDR A:0x78d780c
y.create.l HWIO_USB2_HSIC_USB_OTG_HS_BAM_P_PSM_CNTXT_3_1_ADDR A:0x78d880c
y.create.l HWIO_USB2_HSIC_USB_OTG_HS_BAM_P_PSM_CNTXT_4_0_ADDR A:0x78d7810
y.create.l HWIO_USB2_HSIC_USB_OTG_HS_BAM_P_PSM_CNTXT_4_1_ADDR A:0x78d8810
y.create.l HWIO_USB2_HSIC_USB_OTG_HS_BAM_P_PSM_CNTXT_5_0_ADDR A:0x78d7814
y.create.l HWIO_USB2_HSIC_USB_OTG_HS_BAM_P_PSM_CNTXT_5_1_ADDR A:0x78d8814
y.create.l HWIO_USB2_HSIC_USB_OTG_HS_BAM_P_EVNT_REG0_ADDR A:0x78d7818
y.create.l HWIO_USB2_HSIC_USB_OTG_HS_BAM_P_EVNT_REG1_ADDR A:0x78d8818
y.create.l HWIO_USB2_HSIC_USB_OTG_HS_BAM_P_DESC_FIFO_ADDR0_ADDR A:0x78d781c
y.create.l HWIO_USB2_HSIC_USB_OTG_HS_BAM_P_DESC_FIFO_ADDR1_ADDR A:0x78d881c
y.create.l HWIO_USB2_HSIC_USB_OTG_HS_BAM_P_FIFO_SIZES0_ADDR A:0x78d7820
y.create.l HWIO_USB2_HSIC_USB_OTG_HS_BAM_P_FIFO_SIZES1_ADDR A:0x78d8820
y.create.l HWIO_USB2_HSIC_USB_OTG_HS_BAM_P_DATA_FIFO_ADDR0_ADDR A:0x78d7824
y.create.l HWIO_USB2_HSIC_USB_OTG_HS_BAM_P_DATA_FIFO_ADDR1_ADDR A:0x78d8824
y.create.l HWIO_USB2_HSIC_USB_OTG_HS_BAM_P_EVNT_GEN_TRSHLD0_ADDR A:0x78d7828
y.create.l HWIO_USB2_HSIC_USB_OTG_HS_BAM_P_EVNT_GEN_TRSHLD1_ADDR A:0x78d8828
y.create.l HWIO_USB2_HSIC_USB_OTG_HS_BAM_P_EVNT_DEST_ADDR0_ADDR A:0x78d782c
y.create.l HWIO_USB2_HSIC_USB_OTG_HS_BAM_P_EVNT_DEST_ADDR1_ADDR A:0x78d882c
y.create.l HWIO_USB2_HSIC_USB_OTG_HS_BAM_P_DF_CNTXT_0_ADDR A:0x78d7830
y.create.l HWIO_USB2_HSIC_USB_OTG_HS_BAM_P_DF_CNTXT_1_ADDR A:0x78d8830
y.create.l HWIO_USB2_HSIC_USB_OTG_HS_BAM_P_RETR_CNTXT_0_ADDR A:0x78d7834
y.create.l HWIO_USB2_HSIC_USB_OTG_HS_BAM_P_RETR_CNTXT_1_ADDR A:0x78d8834
y.create.l HWIO_USB2_HSIC_USB_OTG_HS_BAM_P_SI_CNTXT_0_ADDR A:0x78d7838
y.create.l HWIO_USB2_HSIC_USB_OTG_HS_BAM_P_SI_CNTXT_1_ADDR A:0x78d8838
y.create.l HWIO_USB2_HSIC_USB_OTG_HS_BAM_P_PSM_CNTXT_3_LSB0_ADDR A:0x78d7900
y.create.l HWIO_USB2_HSIC_USB_OTG_HS_BAM_P_PSM_CNTXT_3_LSB1_ADDR A:0x78d8900
y.create.l HWIO_USB2_HSIC_USB_OTG_HS_BAM_P_PSM_CNTXT_3_MSB0_ADDR A:0x78d7904
y.create.l HWIO_USB2_HSIC_USB_OTG_HS_BAM_P_PSM_CNTXT_3_MSB1_ADDR A:0x78d8904
y.create.l HWIO_USB2_HSIC_USB_OTG_HS_BAM_P_DESC_FIFO_ADDR_LSB0_ADDR A:0x78d7910
y.create.l HWIO_USB2_HSIC_USB_OTG_HS_BAM_P_DESC_FIFO_ADDR_LSB1_ADDR A:0x78d8910
y.create.l HWIO_USB2_HSIC_USB_OTG_HS_BAM_P_DESC_FIFO_ADDR_MSB0_ADDR A:0x78d7914
y.create.l HWIO_USB2_HSIC_USB_OTG_HS_BAM_P_DESC_FIFO_ADDR_MSB1_ADDR A:0x78d8914
y.create.l HWIO_USB2_HSIC_USB_OTG_HS_BAM_P_DATA_FIFO_ADDR_LSB0_ADDR A:0x78d7920
y.create.l HWIO_USB2_HSIC_USB_OTG_HS_BAM_P_DATA_FIFO_ADDR_LSB1_ADDR A:0x78d8920
y.create.l HWIO_USB2_HSIC_USB_OTG_HS_BAM_P_DATA_FIFO_ADDR_MSB0_ADDR A:0x78d7924
y.create.l HWIO_USB2_HSIC_USB_OTG_HS_BAM_P_DATA_FIFO_ADDR_MSB1_ADDR A:0x78d8924
y.create.l HWIO_USB2_HSIC_USB_OTG_HS_BAM_P_EVNT_DEST_ADDR_LSB0_ADDR A:0x78d7930
y.create.l HWIO_USB2_HSIC_USB_OTG_HS_BAM_P_EVNT_DEST_ADDR_LSB1_ADDR A:0x78d8930
y.create.l HWIO_USB2_HSIC_USB_OTG_HS_BAM_P_EVNT_DEST_ADDR_MSB0_ADDR A:0x78d7934
y.create.l HWIO_USB2_HSIC_USB_OTG_HS_BAM_P_EVNT_DEST_ADDR_MSB1_ADDR A:0x78d8934
y.create.l HWIO_USB2_PHY_USB_PHY_REVISION_ID0_ADDR A:0x6c000
y.create.l HWIO_USB2_PHY_USB_PHY_REVISION_ID1_ADDR A:0x6c004
y.create.l HWIO_USB2_PHY_USB_PHY_REVISION_ID2_ADDR A:0x6c008
y.create.l HWIO_USB2_PHY_USB_PHY_REVISION_ID3_ADDR A:0x6c00c
y.create.l HWIO_USB2_PHY_USB_PHY_DEBUG_BUS_STAT0_ADDR A:0x6c010
y.create.l HWIO_USB2_PHY_USB_PHY_DEBUG_BUS_STAT1_ADDR A:0x6c014
y.create.l HWIO_USB2_PHY_USB_PHY_DEBUG_BUS_STAT2_ADDR A:0x6c018
y.create.l HWIO_USB2_PHY_USB_PHY_DEBUG_BUS_STAT3_ADDR A:0x6c01c
y.create.l HWIO_USB2_PHY_USB_PHY_HS_RX_TESTER_OUT_1_ADDR A:0x6c020
y.create.l HWIO_USB2_PHY_USB_PHY_CHARGING_DET_OUTPUT_ADDR A:0x6c024
y.create.l HWIO_USB2_PHY_USB_PHY_HS_PHY_IRQ_STAT_ADDR A:0x6c028
y.create.l HWIO_USB2_PHY_USB_PHY_HS_PHY_TEST_OUT_1_ADDR A:0x6c02c
y.create.l HWIO_USB2_PHY_USB_PHY_UTMI_VEC4_STATUS_ADDR A:0x6c030
y.create.l HWIO_USB2_PHY_USB_PHY_ULPI_VEC0_STATUS_ADDR A:0x6c034
y.create.l HWIO_USB2_PHY_USB_PHY_ULPI_VEC1_STATUS_ADDR A:0x6c038
y.create.l HWIO_USB2_PHY_USB_PHY_INTERRUPT_STATUS0_ADDR A:0x6c03c
y.create.l HWIO_USB2_PHY_USB_PHY_INTERRUPT_STATUS1_ADDR A:0x6c040
y.create.l HWIO_USB2_PHY_USB_PHY_RX_CHK_ERR_CNT1_STATUS_ADDR A:0x6c044
y.create.l HWIO_USB2_PHY_USB_PHY_RX_CHK_STATUS_ADDR A:0x6c048
y.create.l HWIO_USB2_PHY_USB_PHY_REFCLK_RXTAP_TEST_STATUS_ADDR A:0x6c04c
y.create.l HWIO_USB2_PHY_USB_PHY_UTMI_RX_DATAL_STATUS_ADDR A:0x6c050
y.create.l HWIO_USB2_PHY_USB_PHY_UTMI_RX_DATAH_STATUS_ADDR A:0x6c054
y.create.l HWIO_USB2_PHY_USB_PHY_UTMI_RX_PORT_STATUS_ADDR A:0x6c058
y.create.l HWIO_USB2_PHY_USB_PHY_INTERRUPT_SRC_STATUS_ADDR A:0x6c05c
y.create.l HWIO_USB2_PHY_USB_PHY_UTMI_CTRL0_ADDR A:0x6c060
y.create.l HWIO_USB2_PHY_USB_PHY_UTMI_CTRL1_ADDR A:0x6c064
y.create.l HWIO_USB2_PHY_USB_PHY_UTMI_CTRL2_ADDR A:0x6c068
y.create.l HWIO_USB2_PHY_USB_PHY_UTMI_CTRL3_ADDR A:0x6c06c
y.create.l HWIO_USB2_PHY_USB_PHY_UTMI_CTRL4_ADDR A:0x6c070
y.create.l HWIO_USB2_PHY_USB_PHY_UTMI_CTRL5_ADDR A:0x6c074
y.create.l HWIO_USB2_PHY_USB_PHY_HS_PHY_CTRL_COMMON0_ADDR A:0x6c078
y.create.l HWIO_USB2_PHY_USB_PHY_HS_PHY_CTRL_COMMON1_ADDR A:0x6c07c
y.create.l HWIO_USB2_PHY_USB_PHY_HS_PHY_CTRL_COMMON2_ADDR A:0x6c080
y.create.l HWIO_USB2_PHY_USB_PHY_HS_PHY_CTRL_COMMON3_ADDR A:0x6c084
y.create.l HWIO_USB2_PHY_USB_PHY_HS_PHY_CTRL0_ADDR A:0x6c088
y.create.l HWIO_USB2_PHY_USB_PHY_HS_PHY_CTRL1_ADDR A:0x6c08c
y.create.l HWIO_USB2_PHY_USB_PHY_HS_PHY_CTRL2_ADDR A:0x6c090
y.create.l HWIO_USB2_PHY_USB_PHY_HS_PHY_CTRL3_ADDR A:0x6c094
y.create.l HWIO_USB2_PHY_USB_PHY_PARAMETER_OVERRIDE_X0_ADDR A:0x6c098
y.create.l HWIO_USB2_PHY_USB_PHY_PARAMETER_OVERRIDE_X1_ADDR A:0x6c09c
y.create.l HWIO_USB2_PHY_USB_PHY_PARAMETER_OVERRIDE_X2_ADDR A:0x6c0a0
y.create.l HWIO_USB2_PHY_USB_PHY_PARAMETER_OVERRIDE_X3_ADDR A:0x6c0a4
y.create.l HWIO_USB2_PHY_USB_PHY_CHARGING_DET_CTRL_ADDR A:0x6c0a8
y.create.l HWIO_USB2_PHY_USB_PHY_HS_PHY_TEST0_ADDR A:0x6c0ac
y.create.l HWIO_USB2_PHY_USB_PHY_HS_PHY_TEST1_ADDR A:0x6c0b0
y.create.l HWIO_USB2_PHY_USB_PHY_HS_RX_TESTER_1_REG0_ADDR A:0x6c0b4
y.create.l HWIO_USB2_PHY_USB_PHY_HS_RX_TESTER_1_REG1_ADDR A:0x6c0b8
y.create.l HWIO_USB2_PHY_USB_PHY_HS_RX_TESTER_1_REG3_ADDR A:0x6c0bc
y.create.l HWIO_USB2_PHY_USB_PHY_TCSR_CTRL_ADDR A:0x6c0c0
y.create.l HWIO_USB2_PHY_USB_PHY_CFG0_ADDR A:0x6c0c4
y.create.l HWIO_USB2_PHY_UTMI_PHY_CMN_CTRL0_ADDR A:0x6c0c8
y.create.l HWIO_USB2_PHY_UTMI_PHY_CMN_CTRL1_ADDR A:0x6c0cc
y.create.l HWIO_USB2_PHY_USB_PHY_IRQ_CMD_ADDR A:0x6c0d0
y.create.l HWIO_USB2_PHY_USB_PHY_INTERRUPT_MASK0_ADDR A:0x6c0d4
y.create.l HWIO_USB2_PHY_USB_PHY_INTERRUPT_MASK1_ADDR A:0x6c0d8
y.create.l HWIO_USB2_PHY_USB_PHY_INTERRUPT_CLEAR0_ADDR A:0x6c0dc
y.create.l HWIO_USB2_PHY_USB_PHY_INTERRUPT_CLEAR1_ADDR A:0x6c0e0
y.create.l HWIO_USB2_PHY_USB_PHY_REFCLK_CTRL_ADDR A:0x6c0e8
y.create.l HWIO_USB2_PHY_USB_PHY_PWRDOWN_CTRL_ADDR A:0x6c0ec
y.create.l HWIO_USB2_PHY_USB_PHY_ULPI_OVERRIDE_7_0_ADDR A:0x6c0f0
y.create.l HWIO_USB2_PHY_USB_PHY_ULPI_OVERRIDE_15_8_ADDR A:0x6c0f4
y.create.l HWIO_USB2_PHY_USB_PHY_ULPI_OVERRIDE_23_16_ADDR A:0x6c0f8
y.create.l HWIO_USB2_PHY_USB_PHY_ULPI_OVERRIDE_31_24_ADDR A:0x6c0fc
y.create.l HWIO_USB2_PHY_USB_PHY_TEST_DEBUG_CTRL_ADDR A:0x6c104
y.create.l HWIO_USB2_PHY_USB_PHY_RESET_CTRL_ADDR A:0x6c108
y.create.l HWIO_VENUS0_VENUS_SS_ENC_INTR_STATUS_ADDR A:0x1d00000
y.create.l HWIO_VENUS0_VENUS_SS_ENC_INTR_MASK_ADDR A:0x1d00004
y.create.l HWIO_VENUS0_VENUS_SS_ENC_SPARE_0_ADDR A:0x1d00008
y.create.l HWIO_VENUS0_VENUS_SS_ENC_CLOCK_HALT_ADDR A:0x1d0000c
y.create.l HWIO_VENUS0_VENUS_SS_ENC_SPARE_1_ADDR A:0x1d00010
y.create.l HWIO_VENUS0_VENUS_SS_ENC_WDLOAD0_ADDR A:0x1d00014
y.create.l HWIO_VENUS0_VENUS_SS_ENC_WDLOAD1_ADDR A:0x1d00018
y.create.l HWIO_VENUS0_VENUS_SS_ENC_WDLOAD2_ADDR A:0x1d0001c
y.create.l HWIO_VENUS0_VENUS_SS_ENC_WDVALUE0_ADDR A:0x1d00020
y.create.l HWIO_VENUS0_VENUS_SS_ENC_WDVALUE1_ADDR A:0x1d00024
y.create.l HWIO_VENUS0_VENUS_SS_ENC_WDVALUE2_ADDR A:0x1d00028
y.create.l HWIO_VENUS0_VENUS_SS_ENC_WD_IRQ_STATUS_ADDR A:0x1d0002c
y.create.l HWIO_VENUS0_VENUS_SS_ENC_WD_IRQ_MASK_ADDR A:0x1d00030
y.create.l HWIO_VENUS0_VENUS_SS_ENC_WD_IRQ_CLEAR_ADDR A:0x1d00034
y.create.l HWIO_VENUS0_VENUS_SS_ENC_CLOCK_EN_ADDR A:0x1d00038
y.create.l HWIO_VENUS0_VENUS_SS_ENC_SW_RESET_ADDR A:0x1d0003c
y.create.l HWIO_VENUS0_VENUS_SS_ENC_SPARE_2_ADDR A:0x1d00040
y.create.l HWIO_VENUS0_VENUS_VSP_TOP_ENC_STATUS_ADDR A:0x1d01000
y.create.l HWIO_VENUS0_VENUS_VSP_TOP_ENC_MASK_ADDR A:0x1d01004
y.create.l HWIO_VENUS0_VENUS_VSP_TOP_ENC_SPARE_0_ADDR A:0x1d01008
y.create.l HWIO_VENUS0_VENUS_VSP_TOP_ENC_SPARE_1_ADDR A:0x1d0100c
y.create.l HWIO_VENUS0_VENUS_VSP_TOP_ENC_SPARE_2_ADDR A:0x1d01010
y.create.l HWIO_VENUS0_VENUS_VSP_TOP_ENC_SDE_CP_STATUS_ADDR A:0x1d01014
y.create.l HWIO_VENUS0_VENUS_VSP_CCE_ENC_CMD_ADDR A:0x1d02000
y.create.l HWIO_VENUS0_VENUS_VSP_CCE_ENC_RESULT_ADDR A:0x1d02004
y.create.l HWIO_VENUS0_VENUS_VSP_CCE_ENC_CP_CODEC_CONFIG_ADDR A:0x1d02028
y.create.l HWIO_VENUS0_VENUS_VSP_CCE_ENC_CP_DMA_RD_OFFSET_ADDR A:0x1d0202c
y.create.l HWIO_VENUS0_VENUS_VSP_CCE_ENC_CP_DMA_WR_OFFSET_ADDR A:0x1d02030
y.create.l HWIO_VENUS0_VENUS_VSP_CCE_ENC_CP_DMA_SIZE_ADDR A:0x1d02034
y.create.l HWIO_VENUS0_VENUS_VSP_CCE_ENC_FIFO_STATUS_ADDR A:0x1d02038
y.create.l HWIO_VENUS0_VENUS_VSP_CCE_ENC_CMD_STATUS_ADDR A:0x1d0203c
y.create.l HWIO_VENUS0_VENUS_VSP_CCE_ENC_CMD_STATUS_CLEAR_ADDR A:0x1d02040
y.create.l HWIO_VENUS0_VENUS_VSP_CCE_ENC_CMD_IRQ_MASK_ADDR A:0x1d02044
y.create.l HWIO_VENUS0_VENUS_VSP_CCE_ENC_CMD_RSLT_QUEUE_TIMEOUT_CFG_ADDR A:0x1d02048
y.create.l HWIO_VENUS0_VENUS_VSP_CCE_ENC_CMD_TEST_BUS_CONTROL_ADDR A:0x1d0204c
y.create.l HWIO_VENUS0_VENUS_VSP_CCE_ENC_CMD_TEST_BUS_REGISTER_ADDR A:0x1d02050
y.create.l HWIO_VENUS0_VENUS_VSP_CCE_ENC_SW_RESET_ADDR A:0x1d02054
y.create.l HWIO_VENUS0_VENUS_VSP_CCE_ENC_SPARE_0_ADDR A:0x1d02058
y.create.l HWIO_VENUS0_VENUS_VSP_SDE_ENC_TOP_AP_START_ADDR A:0x1d03000
y.create.l HWIO_VENUS0_VENUS_VSP_SDE_ENC_TOP_AP_CONFIG_ADDR A:0x1d03004
y.create.l HWIO_VENUS0_VENUS_VSP_SDE_ENC_TOP_AP_SIZE_ADDR A:0x1d03008
y.create.l HWIO_VENUS0_VENUS_VSP_SDE_ENC_TOP_CODEC_CONFIG_ADDR A:0x1d0300c
y.create.l HWIO_VENUS0_VENUS_VSP_SDE_ENC_TOP_SW_RESET_ADDR A:0x1d03010
y.create.l HWIO_VENUS0_VENUS_VSP_SDE_ENC_ENC_CFG_ADDR A:0x1d03014
y.create.l HWIO_VENUS0_VENUS_VSP_SDE_ENC_BIT_BUF_WR_OFFSET_STATUS_ADDR A:0x1d03018
y.create.l HWIO_VENUS0_VENUS_VSP_SDE_ENC_BIT_BUF_WR_OFFSET_ADDR A:0x1d0301c
y.create.l HWIO_VENUS0_VENUS_VSP_SDE_ENC_BIT_BUF_SIZE_ADDR A:0x1d03020
y.create.l HWIO_VENUS0_VENUS_VSP_SDE_ENC_BIT_BUF_WR_OFFSET2_ADDR A:0x1d03024
y.create.l HWIO_VENUS0_VENUS_VSP_SDE_ENC_BIT_BUF_SIZE2_ADDR A:0x1d03028
y.create.l HWIO_VENUS0_VENUS_VSP_SDE_ENC_SLICE_INFO_BUF_WR_OFFSET_ADDR A:0x1d0302c
y.create.l HWIO_VENUS0_VENUS_VSP_SDE_ENC_SLICE_INFO_BUF_SIZE_ADDR A:0x1d03030
y.create.l HWIO_VENUS0_VENUS_VSP_SDE_ENC_BIN_BUF_RD_OFFSET0_ADDR A:0x1d03034
y.create.l HWIO_VENUS0_VENUS_VSP_SDE_ENC_BIN_BUF_RD_OFFSET1_ADDR A:0x1d03038
y.create.l HWIO_VENUS0_VENUS_VSP_SDE_ENC_BIN_BUF_RD_SIZE0_ADDR A:0x1d0303c
y.create.l HWIO_VENUS0_VENUS_VSP_SDE_ENC_BIN_BUF_RD_SIZE1_ADDR A:0x1d03040
y.create.l HWIO_VENUS0_VENUS_VSP_SDE_ENC_BIN_BUF_RD_BYTE_COUNT0_ADDR A:0x1d03044
y.create.l HWIO_VENUS0_VENUS_VSP_SDE_ENC_BIN_BUF_RD_BYTE_COUNT1_ADDR A:0x1d03048
y.create.l HWIO_VENUS0_VENUS_VSP_SDE_ENC_SLICE_BIT_COUNT_LIMIT_ADDR A:0x1d0304c
y.create.l HWIO_VENUS0_VENUS_VSP_SDE_ENC_LCU_POS_INFO_ADDR A:0x1d03050
y.create.l HWIO_VENUS0_VENUS_VSP_SDE_ENC_NUM_LCU_INFO_ADDR A:0x1d03054
y.create.l HWIO_VENUS0_VENUS_VSP_SDE_ENC_NUM_EPC_ADDR A:0x1d03058
y.create.l HWIO_VENUS0_VENUS_VSP_SDE_ENC_NUM_SLICE_ADDR A:0x1d0305c
y.create.l HWIO_VENUS0_VENUS_VSP_SDE_ENC_CUHDR_BITS_ADDR A:0x1d03060
y.create.l HWIO_VENUS0_VENUS_VSP_SDE_ENC_RESID_BITS_ADDR A:0x1d03064
y.create.l HWIO_VENUS0_VENUS_VSP_SDE_ENC_HEADER_BITS_ADDR A:0x1d03068
y.create.l HWIO_VENUS0_VENUS_VSP_SDE_ENC_IRQ_STATUS_ADDR A:0x1d0306c
y.create.l HWIO_VENUS0_VENUS_VSP_SDE_ENC_IRQ_CLEAR_ADDR A:0x1d03070
y.create.l HWIO_VENUS0_VENUS_VSP_SDE_ENC_IRQ_MASK_ADDR A:0x1d03074
y.create.l HWIO_VENUS0_VENUS_VSP_SDE_ENC_LC_PARAM_ADDR A:0x1d03078
y.create.l HWIO_VENUS0_VENUS_VSP_SDE_ENC_LC_STATUS_ADDR A:0x1d0307c
y.create.l HWIO_VENUS0_VENUS_VSP_SDE_ENC_SLICE_INFO_OFFSET_ADDR A:0x1d03080
y.create.l HWIO_VENUS0_VENUS_VSP_SDE_ENC_SLICE_INFO_SIZE_ADDR A:0x1d03084
y.create.l HWIO_VENUS0_VENUS_VSP_SDE_ENC_SLICE_INFO_FIFO_STATUS_ADDR A:0x1d03088
y.create.l HWIO_VENUS0_VENUS_VSP_SDE_ENC_TILE_INIT_ADDR A:0x1d0308c
y.create.l HWIO_VENUS0_VENUS_VSP_SDE_ENC_TILE_X_ADDR A:0x1d03090
y.create.l HWIO_VENUS0_VENUS_VSP_SDE_ENC_TILE_Y_ADDR A:0x1d03094
y.create.l HWIO_VENUS0_VENUS_VSP_SDE_ENC_TEST_BUS_CONTROL_ADDR A:0x1d03098
y.create.l HWIO_VENUS0_VENUS_VSP_SDE_ENC_TEST_BUS_REG_ADDR A:0x1d0309c
y.create.l HWIO_VENUS0_VENUS_VSP_SDE_ENC_TOP_SINGLE_STEP_CONTROL_ADDR A:0x1d030a0
y.create.l HWIO_VENUS0_VENUS_VSP_SDE_ENC_TOP_SPARE_ADDR A:0x1d030a4
y.create.l HWIO_VENUS0_VENUS_VSP_SDE_ENC_H265E_SLICE_CFG_ADDR A:0x1d030a8
y.create.l HWIO_VENUS0_VENUS_VSP_SDE_ENC_H265E_SLICE_CFG2_ADDR A:0x1d030ac
y.create.l HWIO_VENUS0_VENUS_VSP_SDE_ENC_H264E_SLICE_CFG_ADDR A:0x1d030b0
y.create.l HWIO_VENUS0_VENUS_VSP_SDE_ENC_VPXA_CTRL_ADDR A:0x1d030b4
y.create.l HWIO_VENUS0_VENUS_VSP_SDE_ENC_VPX_CFG_0_ADDR A:0x1d030b8
y.create.l HWIO_VENUS0_VENUS_VSP_SDE_ENC_VPXA_BOOL_VALUE_ADDR A:0x1d030bc
y.create.l HWIO_VENUS0_VENUS_VSP_SDE_ENC_VPXA_BOOL_PARAM_0_ADDR A:0x1d030c0
y.create.l HWIO_VENUS0_VENUS_VSP_SDE_ENC_FRM_BIT_RD_SIZE_ADDR A:0x1d030c4
y.create.l HWIO_VENUS0_VENUS_VSP_SDE_ENC_SEGMENT_PROB_ADDR A:0x1d030c8
y.create.l HWIO_VENUS0_VENUS_VSP_SDE_ENC_SEGMENT_TREE_PROB_0_ADDR A:0x1d030cc
y.create.l HWIO_VENUS0_VENUS_VSP_SDE_ENC_SEGMENT_TREE_PROB_1_ADDR A:0x1d030d0
y.create.l HWIO_VENUS0_VENUS_VSP_SDE_ENC_SPARE_0_ADDR A:0x1d030d4
y.create.l HWIO_VENUS0_VENUS_VPP_TOP_ENC_STATUS_ADDR A:0x1d04000
y.create.l HWIO_VENUS0_VENUS_VPP_TOP_ENC_MASK_ADDR A:0x1d04004
y.create.l HWIO_VENUS0_VENUS_VPP_TOP_ENC_SPARE_0_ADDR A:0x1d04008
y.create.l HWIO_VENUS0_VENUS_VPP_TOP_ME_STANDALONE_MODE_ADDR A:0x1d0400c
y.create.l HWIO_VENUS0_VENUS_VPP_TOP_START_ADDR A:0x1d04010
y.create.l HWIO_VENUS0_VENUS_VPP_TOP_ENC_SPARE_1_ADDR A:0x1d04014
y.create.l HWIO_VENUS0_VENUS_VPP_TOP_ENC_SE_CP_STATUS_ADDR A:0x1d04018
y.create.l HWIO_VENUS0_VENUS_VPP_SE_ENC_START_ADDR A:0x1d05000
y.create.l HWIO_VENUS0_VENUS_VPP_SE_ENC_TOP_CONFIG_ADDR A:0x1d05004
y.create.l HWIO_VENUS0_VENUS_VPP_SE_ENC_TOP_PIC_SIZE_IN_SAMPLES_ADDR A:0x1d05008
y.create.l HWIO_VENUS0_VENUS_VPP_SE_ENC_CFG_ADDR A:0x1d0500c
y.create.l HWIO_VENUS0_VENUS_VPP_SE_ENC_TILE_X_ADDR A:0x1d05010
y.create.l HWIO_VENUS0_VENUS_VPP_SE_ENC_TILE_Y_ADDR A:0x1d05014
y.create.l HWIO_VENUS0_VENUS_VPP_SE_ENC_SLICE_CFG_ADDR A:0x1d05018
y.create.l HWIO_VENUS0_VENUS_VPP_SE_ENC_SLICE_CFG2_ADDR A:0x1d0501c
y.create.l HWIO_VENUS0_VENUS_VPP_SE_ENC_MP4E_CFG_ADDR A:0x1d05020
y.create.l HWIO_VENUS0_VENUS_VPP_SE_ENC_H264E_VPXE_SLICE_CFG_ADDR A:0x1d05024
y.create.l HWIO_VENUS0_VENUS_VPP_SE_ENC_PACKER_CFG1_ADDR A:0x1d05028
y.create.l HWIO_VENUS0_VENUS_VPP_SE_ENC_PACKER_CFG2_ADDR A:0x1d0502c
y.create.l HWIO_VENUS0_VENUS_VPP_SE_ENC_MEM_ADDR_ADDR A:0x1d05030
y.create.l HWIO_VENUS0_VENUS_VPP_SE_ENC_MEM_DATA_ADDR A:0x1d05034
y.create.l HWIO_VENUS0_VENUS_VPP_SE_ENC_RSHDR_SE_ADDR_ADDR A:0x1d05038
y.create.l HWIO_VENUS0_VENUS_VPP_SE_ENC_DSHDR_SE_ADDR_ADDR A:0x1d0503c
y.create.l HWIO_VENUS0_VENUS_VPP_SE_ENC_FRHDR_SE_ADDR_ADDR A:0x1d05040
y.create.l HWIO_VENUS0_VENUS_VPP_SE_ENC_LCU_OVR_ADDR A:0x1d05044
y.create.l HWIO_VENUS0_VENUS_VPP_SE_ENC_SG_STATUS_ADDR A:0x1d05048
y.create.l HWIO_VENUS0_VENUS_VPP_SE_ENC_STATUS_CLEAR_ADDR A:0x1d0504c
y.create.l HWIO_VENUS0_VENUS_VPP_SE_ENC_IRQ_MASK_ADDR A:0x1d05050
y.create.l HWIO_VENUS0_VENUS_VPP_SE_ENC_LCU_POS_INFO_R0_ADDR A:0x1d05054
y.create.l HWIO_VENUS0_VENUS_VPP_SE_ENC_LCU_POS_INFO_R1_ADDR A:0x1d05058
y.create.l HWIO_VENUS0_VENUS_VPP_SE_ENC_CUHDR_BINS_ADDR A:0x1d0505c
y.create.l HWIO_VENUS0_VENUS_VPP_SE_ENC_RESID_BINS_ADDR A:0x1d05060
y.create.l HWIO_VENUS0_VENUS_VPP_SE_ENC_HEADER_BITS_ADDR A:0x1d05064
y.create.l HWIO_VENUS0_VENUS_VPP_SE_ENC_LCU_POS_INFO_ADDR A:0x1d05068
y.create.l HWIO_VENUS0_VENUS_VPP_SE_ENC_LC_PARAM_ADDR A:0x1d0506c
y.create.l HWIO_VENUS0_VENUS_VPP_SE_ENC_LC_STATUS_ADDR A:0x1d05070
y.create.l HWIO_VENUS0_VENUS_VPP_SE_ENC_TEST_BUS_CONTROL_ADDR A:0x1d05074
y.create.l HWIO_VENUS0_VENUS_VPP_SE_ENC_TEST_BUS_REG_ADDR A:0x1d05078
y.create.l HWIO_VENUS0_VENUS_VPP_SE_ENC_PACKER_STATUS1_ADDR A:0x1d0507c
y.create.l HWIO_VENUS0_VENUS_VPP_SE_ENC_PACKER_STATUS2_ADDR A:0x1d05080
y.create.l HWIO_VENUS0_VENUS_VPP_SE_ENC_PACKER_STATUS3_ADDR A:0x1d05084
y.create.l HWIO_VENUS0_VENUS_VPP_SE_ENC_PACKER_EXT0_OFFSET_ADDR A:0x1d05088
y.create.l HWIO_VENUS0_VENUS_VPP_SE_ENC_PACKER_EXT0_BUFSIZE_ADDR A:0x1d0508c
y.create.l HWIO_VENUS0_VENUS_VPP_SE_ENC_PACKER_EXT1_OFFSET_ADDR A:0x1d05090
y.create.l HWIO_VENUS0_VENUS_VPP_SE_ENC_PACKER_EXT1_BUFSIZE_ADDR A:0x1d05094
y.create.l HWIO_VENUS0_VENUS_VPP_SE_ENC_BIT_BUF_WR_OFFSET_STATUS_ADDR A:0x1d05098
y.create.l HWIO_VENUS0_VENUS_VPP_SE_ENC_SLICE_INFO_BUF_WR_OFFSET_ADDR A:0x1d0509c
y.create.l HWIO_VENUS0_VENUS_VPP_SE_ENC_SLICE_INFO_BUF_SIZE_ADDR A:0x1d050a0
y.create.l HWIO_VENUS0_VENUS_VPP_SE_ENC_SLICE_BIT_COUNT_LIMIT_ADDR A:0x1d050a4
y.create.l HWIO_VENUS0_VENUS_VPP_SE_ENC_NUM_EPC_ADDR A:0x1d050a8
y.create.l HWIO_VENUS0_VENUS_VPP_SE_ENC_NUM_SLICE_ADDR A:0x1d050ac
y.create.l HWIO_VENUS0_VENUS_VPP_SE_ENC_SLICE_INFO_OFFSET_ADDR A:0x1d050b0
y.create.l HWIO_VENUS0_VENUS_VPP_SE_ENC_SLICE_INFO_SIZE_ADDR A:0x1d050b4
y.create.l HWIO_VENUS0_VENUS_VPP_SE_ENC_SLICE_INFO_FIFO_STATUS_ADDR A:0x1d050b8
y.create.l HWIO_VENUS0_VENUS_VSP_SE_ENC_TILE_INIT_ADDR A:0x1d050bc
y.create.l HWIO_VENUS0_VENUS_VPP_SE_ENC_SPARE_0_ADDR A:0x1d050c0
y.create.l HWIO_VENUS0_VENUS_VPP_SE_ENC_SPARE_1_ADDR A:0x1d050c4
y.create.l HWIO_VENUS0_VENUS_VPP_PE_ENC_PIC_SIZE_ADDR A:0x1d06000
y.create.l HWIO_VENUS0_VENUS_VPP_PE_ENC_PIC_CFG_ADDR A:0x1d06004
y.create.l HWIO_VENUS0_VENUS_VPP_PE_ENC_REF_BYTES_PER_LINE_ADDR A:0x1d06008
y.create.l HWIO_VENUS0_VENUS_VPP_PE_ENC_FRAME_CONTROL_ADDR A:0x1d0600c
y.create.l HWIO_VENUS0_VENUS_VPP_PE_ENC_FRAME_ENC_CFG_ADDR A:0x1d06010
y.create.l HWIO_VENUS0_VENUS_VPP_PE_ENC_IRQ_MASK_ADDR A:0x1d06014
y.create.l HWIO_VENUS0_VENUS_VPP_PE_ENC_IRQ_STATUS_ADDR A:0x1d06018
y.create.l HWIO_VENUS0_VENUS_VPP_PE_ENC_IRQ_CLEAR_ADDR A:0x1d0601c
y.create.l HWIO_VENUS0_VENUS_VPP_PE_ENC_TEST_BUS_CONTROL_ADDR A:0x1d06020
y.create.l HWIO_VENUS0_VENUS_VPP_PE_ENC_TEST_BUS_REGISTER_ADDR A:0x1d06024
y.create.l HWIO_VENUS0_VENUS_VPP_PE_ENC_SPARE_0_ADDR A:0x1d06028
y.create.l HWIO_VENUS0_VENUS_VPP_TE_ENC_PIC_CFG_ADDR A:0x1d07000
y.create.l HWIO_VENUS0_VENUS_VPP_TE_ENC_PIC_ENC_CFG_ADDR A:0x1d07004
y.create.l HWIO_VENUS0_VENUS_VPP_TE_ENC_ZBD_LUMA_CFG_ADDR A:0x1d07008
y.create.l HWIO_VENUS0_VENUS_VPP_TE_ENC_ZBD_CHROMA_CFG_ADDR A:0x1d0700c
y.create.l HWIO_VENUS0_VENUS_VPP_TE_ENC_REDO_INTRA_LUMA_CFG_ADDR A:0x1d07010
y.create.l HWIO_VENUS0_VENUS_VPP_TE_ENC_REDO_INTRA_CHROMA_CFG_ADDR A:0x1d07014
y.create.l HWIO_VENUS0_VENUS_VPP_TE_ENC_TS_LUMA_CFG_ADDR A:0x1d07018
y.create.l HWIO_VENUS0_VENUS_VPP_TE_ENC_TS_CHROMA_CFG_ADDR A:0x1d0701c
y.create.l HWIO_VENUS0_VENUS_VPP_TE_ENC_RC_FRAME_CFG_ADDR A:0x1d07020
y.create.l HWIO_VENUS0_VENUS_VPP_TE_ENC_FRAME_QP_CFG_ADDR A:0x1d07024
y.create.l HWIO_VENUS0_VENUS_VPP_TE_ENC_RC_RHO_QP_CTRL_ADDR A:0x1d07028
y.create.l HWIO_VENUS0_VENUS_VPP_TE_ENC_RC_RHO_QP_L_BOUND_ADDR A:0x1d0702c
y.create.l HWIO_VENUS0_VENUS_VPP_TE_ENC_RC_RHO_QP_L_BOUND_Y2_ADDR A:0x1d07030
y.create.l HWIO_VENUS0_VENUS_VPP_TE_ENC_RC_RHO_QP_L_BOUND_CHROMA_ADDR A:0x1d07034
y.create.l HWIO_VENUS0_VENUS_VPP_TE_ENC_RC_RHO_QP_U_BOUND_ADDR A:0x1d07038
y.create.l HWIO_VENUS0_VENUS_VPP_TE_ENC_RC_RHO_QP_U_BOUND_Y2_ADDR A:0x1d0703c
y.create.l HWIO_VENUS0_VENUS_VPP_TE_ENC_RC_RHO_QP_U_BOUND_CHROMA_ADDR A:0x1d07040
y.create.l HWIO_VENUS0_VENUS_VPP_TE_ENC_RC_MB_LCU_QP_LIMIT_ADDR A:0x1d07044
y.create.l HWIO_VENUS0_VENUS_VPP_TE_ENC_RC_MB_LCU_CFG_ADDR A:0x1d07048
y.create.l HWIO_VENUS0_VENUS_VPP_TE_ENC_RC_TARGET_FRAME_BITS_ADDR A:0x1d0704c
y.create.l HWIO_VENUS0_VENUS_VPP_TE_ENC_RC_SLICE_SIZE_ADDR A:0x1d07050
y.create.l HWIO_VENUS0_VENUS_VPP_TE_ENC_RC_COMPLEXITY_PARAM_ADDR A:0x1d07054
y.create.l HWIO_VENUS0_VENUS_VPP_TE_ENC_FRAME_SIZE_ADDR A:0x1d07058
y.create.l HWIO_VENUS0_VENUS_VPP_TE_ENC_STATUS_ADDR A:0x1d0705c
y.create.l HWIO_VENUS0_VENUS_VPP_TE_ENC_SPARE_ADDR A:0x1d07060
y.create.l HWIO_VENUS0_VENUS_VPP_TE_ENC_SW_RESET_ADDR A:0x1d07064
y.create.l HWIO_VENUS0_VENUS_VPP_TE_ENC_IRQ_MASK_ADDR A:0x1d07068
y.create.l HWIO_VENUS0_VENUS_VPP_TE_ENC_IRQ_STATUS_ADDR A:0x1d0706c
y.create.l HWIO_VENUS0_VENUS_VPP_TE_ENC_IRQ_CLEAR_ADDR A:0x1d07070
y.create.l HWIO_VENUS0_VENUS_VPP_TE_ENC_TEST_BUS_CONTROL_ADDR A:0x1d07074
y.create.l HWIO_VENUS0_VENUS_VPP_TE_ENC_TEST_BUS_REGISTER_ADDR A:0x1d07078
y.create.l HWIO_VENUS0_VENUS_VPP_TE_ENC_RC_MB_SB_SEG_CFG0_ADDR A:0x1d0707c
y.create.l HWIO_VENUS0_VENUS_VPP_TE_ENC_RC_MB_SB_SEG_CFG1_ADDR A:0x1d07080
y.create.l HWIO_VENUS0_VENUS_VPP_TE_ENC_RC_CQP_ADDR_ADDR A:0x1d07084
y.create.l HWIO_VENUS0_VENUS_VPP_TE_ENC_RC_CQP_DATA_ADDR A:0x1d07088
y.create.l HWIO_VENUS0_VENUS_VPP_TE_ENC_RC_CQP_MSB_0_ADDR A:0x1d0708c
y.create.l HWIO_VENUS0_VENUS_VPP_TE_ENC_RC_CQP_MSB_1_ADDR A:0x1d07090
y.create.l HWIO_VENUS0_VENUS_VPP_TE_ENC_RC_CQP_MSB_2_ADDR A:0x1d07094
y.create.l HWIO_VENUS0_VENUS_VPP_TE_ENC_RC_CQP_MSB_3_ADDR A:0x1d07098
y.create.l HWIO_VENUS0_VENUS_VPP_TE_ENC_RC_CQP_MSB_4_ADDR A:0x1d0709c
y.create.l HWIO_VENUS0_VENUS_VPP_TE_ENC_SPARE_1_ADDR A:0x1d070a0
y.create.l HWIO_VENUS0_VENUS_VPP_FE_ENC_PIC_CFG_ADDR A:0x1d08000
y.create.l HWIO_VENUS0_VENUS_VPP_FE_ENC_PIC_SIZE_ADDR A:0x1d08004
y.create.l HWIO_VENUS0_VENUS_VPP_FE_ENC_REF_BYTES_PER_LINE_ADDR A:0x1d08008
y.create.l HWIO_VENUS0_VENUS_VPP_FE_ENC_CODEC_CONFIG_ADDR A:0x1d0800c
y.create.l HWIO_VENUS0_VENUS_VPP_FE_ENC_PIC_CFG1_ADDR A:0x1d08010
y.create.l HWIO_VENUS0_VENUS_VPP_FE_ENC_SAO_MODE0_CFG_ADDR A:0x1d08014
y.create.l HWIO_VENUS0_VENUS_VPP_FE_ENC_SAO_MODE1_CFG_ADDR A:0x1d08018
y.create.l HWIO_VENUS0_VENUS_VPP_FE_ENC_SAO_EO_CLASS_LUMA_CFG_ADDR A:0x1d0801c
y.create.l HWIO_VENUS0_VENUS_VPP_FE_ENC_SAO_EO_CLASS_CHROMA_CFG_ADDR A:0x1d08020
y.create.l HWIO_VENUS0_VENUS_VPP_FE_ENC_SAO_SAO_STATS_ADDR A:0x1d08024
y.create.l HWIO_VENUS0_VENUS_VPP_FE_ENC_STATUS_ADDR A:0x1d08028
y.create.l HWIO_VENUS0_VENUS_VPP_FE_ENC_IRQ_MASK_ADDR A:0x1d0802c
y.create.l HWIO_VENUS0_VENUS_VPP_FE_ENC_IRQ_STATUS_ADDR A:0x1d08030
y.create.l HWIO_VENUS0_VENUS_VPP_FE_ENC_IRQ_CLEAR_ADDR A:0x1d08034
y.create.l HWIO_VENUS0_VENUS_VPP_FE_ENC_SPARE_0_ADDR A:0x1d08038
y.create.l HWIO_VENUS0_VENUS_VPP_SSE_ENC_FRAME_CONFIG_0_ADDR A:0x1d09000
y.create.l HWIO_VENUS0_VENUS_VPP_SSE_ENC_FRAME_CONFIG_1_ADDR A:0x1d09004
y.create.l HWIO_VENUS0_VENUS_VPP_SSE_ENC_SRCH_RANGE_ADDR A:0x1d09008
y.create.l HWIO_VENUS0_VENUS_VPP_SSE_ENC_FRAME_BBOX_ADDR A:0x1d0900c
y.create.l HWIO_VENUS0_VENUS_VPP_SSE_ENC_TESTBUS_SEL_ADDR A:0x1d09010
y.create.l HWIO_VENUS0_VENUS_VPP_SSE_ENC_STATUS_ADDR A:0x1d09014
y.create.l HWIO_VENUS0_VENUS_VPP_SSE_ENC_SPARE_ADDR A:0x1d09018
y.create.l HWIO_VENUS0_VENUS_VPP_SSE_ENC_SPARE_1_ADDR A:0x1d0901c
y.create.l HWIO_VENUS0_VENUS_VPP_ISE_ENC_CONFIG_ADDR A:0x1d0a000
y.create.l HWIO_VENUS0_VENUS_VPP_ISE_ENC_FRAME_SIZE_ADDR A:0x1d0a004
y.create.l HWIO_VENUS0_VENUS_VPP_ISE_ENC_SHAPE_CTRL_ADDR A:0x1d0a008
y.create.l HWIO_VENUS0_VENUS_VPP_ISE_ENC_SHAPE_BIAS_0_ADDR A:0x1d0a00c
y.create.l HWIO_VENUS0_VENUS_VPP_ISE_ENC_SHAPE_BIAS_1_ADDR A:0x1d0a010
y.create.l HWIO_VENUS0_VENUS_VPP_ISE_ENC_SHAPE_BIAS_2_ADDR A:0x1d0a014
y.create.l HWIO_VENUS0_VENUS_VPP_ISE_ENC_PRED_DIR_CTRL_ADDR A:0x1d0a018
y.create.l HWIO_VENUS0_VENUS_VPP_ISE_ENC_PRED_BIAS_ADDR A:0x1d0a01c
y.create.l HWIO_VENUS0_VENUS_VPP_ISE_ENC_RANGE_LIMIT_MVX_ADDR A:0x1d0a020
y.create.l HWIO_VENUS0_VENUS_VPP_ISE_ENC_RANGE_LIMIT_MVY_ADDR A:0x1d0a024
y.create.l HWIO_VENUS0_VENUS_VPP_ISE_ENC_PMV_SRCH_CONFIG_ADDR A:0x1d0a028
y.create.l HWIO_VENUS0_VENUS_VPP_ISE_ENC_PMV_PROC_ORDER_0_ADDR A:0x1d0a02c
y.create.l HWIO_VENUS0_VENUS_VPP_ISE_ENC_PMV_PROC_ORDER_1_ADDR A:0x1d0a030
y.create.l HWIO_VENUS0_VENUS_VPP_ISE_ENC_PMV_PROC_ORDER_2_ADDR A:0x1d0a034
y.create.l HWIO_VENUS0_VENUS_VPP_ISE_ENC_PMV_PROC_ORDER_3_ADDR A:0x1d0a038
y.create.l HWIO_VENUS0_VENUS_VPP_ISE_ENC_PMV_PROC_ORDER_4_ADDR A:0x1d0a03c
y.create.l HWIO_VENUS0_VENUS_VPP_ISE_ENC_PMV_PROC_ORDER_5_ADDR A:0x1d0a040
y.create.l HWIO_VENUS0_VENUS_VPP_ISE_ENC_STATUS_ADDR A:0x1d0a044
y.create.l HWIO_VENUS0_VENUS_VPP_ISE_ENC_TESTBUS_SEL_ADDR A:0x1d0a048
y.create.l HWIO_VENUS0_VENUS_VPP_ISE_ENC_SPARE_ADDR A:0x1d0a04c
y.create.l HWIO_VENUS0_VENUS_VPP_ISE_ENC_SPARE_1_ADDR A:0x1d0a050
y.create.l HWIO_VENUS0_VENUS_VPP_FSE_ENC_CFG_FRAME_SIZE_ADDR A:0x1d0b000
y.create.l HWIO_VENUS0_VENUS_VPP_FSE_ENC_CFG_FRAME_CONTROL_ADDR A:0x1d0b004
y.create.l HWIO_VENUS0_VENUS_VPP_FSE_ENC_CFG_FS_SEARCH_ENABLE_ADDR A:0x1d0b008
y.create.l HWIO_VENUS0_VENUS_VPP_FSE_ENC_CFG_FS_SEARCH_DIR_ADDR A:0x1d0b00c
y.create.l HWIO_VENUS0_VENUS_VPP_FSE_ENC_CFG_FS_ENABLE_MER_DIRECT_MODES_ADDR A:0x1d0b010
y.create.l HWIO_VENUS0_VENUS_VPP_FSE_ENC_CFG_FS_MER_PU_BIAS0_ADDR A:0x1d0b014
y.create.l HWIO_VENUS0_VENUS_VPP_FSE_ENC_CFG_FS_MER_PU_BIAS1_ADDR A:0x1d0b018
y.create.l HWIO_VENUS0_VENUS_VPP_FSE_ENC_CFG_FS_PU_SHAPE_BIAS0_ADDR A:0x1d0b01c
y.create.l HWIO_VENUS0_VENUS_VPP_FSE_ENC_CFG_FS_PU_SHAPE_BIAS1_ADDR A:0x1d0b020
y.create.l HWIO_VENUS0_VENUS_VPP_FSE_ENC_CFG_FS_PRED_DIR_BIAS_ADDR A:0x1d0b024
y.create.l HWIO_VENUS0_VENUS_VPP_FSE_ENC_CFG_SE_CONFIG_BIAS0_ADDR A:0x1d0b028
y.create.l HWIO_VENUS0_VENUS_VPP_FSE_ENC_CFG_SE_CONFIG_BIAS1_ADDR A:0x1d0b02c
y.create.l HWIO_VENUS0_VENUS_VPP_FSE_ENC_CFG_MD_INTRA_BIAS_ADDR A:0x1d0b030
y.create.l HWIO_VENUS0_VENUS_VPP_FSE_ENC_CFG_MD_CU_BIAS_ADDR A:0x1d0b034
y.create.l HWIO_VENUS0_VENUS_VPP_FSE_ENC_CFG_FS_MER_PROCESS_ORDER0_ADDR A:0x1d0b038
y.create.l HWIO_VENUS0_VENUS_VPP_FSE_ENC_CFG_FS_MER_PROCESS_ORDER1_ADDR A:0x1d0b03c
y.create.l HWIO_VENUS0_VENUS_VPP_FSE_ENC_CFG_FS_MER_PROCESS_ORDER2_ADDR A:0x1d0b040
y.create.l HWIO_VENUS0_VENUS_VPP_FSE_ENC_CFG_FS_MER_PROCESS_ORDER3_ADDR A:0x1d0b044
y.create.l HWIO_VENUS0_VENUS_VPP_FSE_ENC_CFG_FS_MER_PROCESS_ORDER4_ADDR A:0x1d0b048
y.create.l HWIO_VENUS0_VENUS_VPP_FSE_ENC_CFG_SE_4X4_MODES0_ADDR A:0x1d0b04c
y.create.l HWIO_VENUS0_VENUS_VPP_FSE_ENC_CFG_SE_4X4_MODES1_ADDR A:0x1d0b050
y.create.l HWIO_VENUS0_VENUS_VPP_FSE_ENC_CFG_SE_8X8_MODES0_ADDR A:0x1d0b054
y.create.l HWIO_VENUS0_VENUS_VPP_FSE_ENC_CFG_SE_8X8_MODES1_ADDR A:0x1d0b058
y.create.l HWIO_VENUS0_VENUS_VPP_FSE_ENC_CFG_SE_16X16_MODES0_ADDR A:0x1d0b05c
y.create.l HWIO_VENUS0_VENUS_VPP_FSE_ENC_CFG_SE_16X16_MODES1_ADDR A:0x1d0b060
y.create.l HWIO_VENUS0_VENUS_VPP_FSE_ENC_CFG_SE_32X32_MODES0_ADDR A:0x1d0b064
y.create.l HWIO_VENUS0_VENUS_VPP_FSE_ENC_CFG_SE_32X32_MODES1_ADDR A:0x1d0b068
y.create.l HWIO_VENUS0_VENUS_VPP_FSE_ENC_FS_COST_BIAS_ADDR A:0x1d0b06c
y.create.l HWIO_VENUS0_VENUS_VPP_FSE_ENC_SE_I4X4_VPX_BIAS_ADDR A:0x1d0b070
y.create.l HWIO_VENUS0_VENUS_VPP_FSE_ENC_SE_I16X16_BIAS_ADDR A:0x1d0b074
y.create.l HWIO_VENUS0_VENUS_VPP_FSE_ENC_GMO_MV_ADDR A:0x1d0b078
y.create.l HWIO_VENUS0_VENUS_VPP_FSE_ENC_DBG_TEST_BUS_SEL_ADDR A:0x1d0b080
y.create.l HWIO_VENUS0_VENUS_VPP_FSE_ENC_FS_PIXEL_CONTROL_ADDR A:0x1d0b084
y.create.l HWIO_VENUS0_VENUS_VPP_FSE_ENC_SPARE_ADDR A:0x1d0b088
y.create.l HWIO_VENUS0_VENUS_VPP_FSE_ENC_SPARE_1_ADDR A:0x1d0b08c
y.create.l HWIO_VENUS0_VENUS_VPP_VPE_ENC_STATUS_ADDR A:0x1d0c000
y.create.l HWIO_VENUS0_VENUS_VPP_VPE_ENC_PIPELINE_SIZE_ADDR A:0x1d0c004
y.create.l HWIO_VENUS0_VENUS_VPP_VPE_ENC_FRAME_SIZE_ADDR A:0x1d0c008
y.create.l HWIO_VENUS0_VENUS_VPP_VPE_ENC_OUT_ROI_SIZE_ADDR A:0x1d0c00c
y.create.l HWIO_VENUS0_VENUS_VPP_VPE_ENC_CFG_ADDR A:0x1d0c010
y.create.l HWIO_VENUS0_VENUS_VPP_VPE_ENC_SRC_UNPACK_PATTERN_ADDR A:0x1d0c014
y.create.l HWIO_VENUS0_VENUS_VPP_VPE_ENC_SRC_SIZE_ADDR A:0x1d0c018
y.create.l HWIO_VENUS0_VENUS_VPP_VPE_ENC_SRC_XY_ADDR A:0x1d0c01c
y.create.l HWIO_VENUS0_VENUS_VPP_VPE_ENC_SRC_IMAGE_SIZE_ADDR A:0x1d0c020
y.create.l HWIO_VENUS0_VENUS_VPP_VPE_ENC_P0_EXTADDR_ADDR A:0x1d0c024
y.create.l HWIO_VENUS0_VENUS_VPP_VPE_ENC_P1_EXTADDR_ADDR A:0x1d0c028
y.create.l HWIO_VENUS0_VENUS_VPP_VPE_ENC_P2_EXTADDR_ADDR A:0x1d0c02c
y.create.l HWIO_VENUS0_VENUS_VPP_VPE_ENC_SRC_YSTRIDE_ADDR A:0x1d0c030
y.create.l HWIO_VENUS0_VENUS_VPP_VPE_ENC_SCALE_PHASEX_STEP_ADDR A:0x1d0c034
y.create.l HWIO_VENUS0_VENUS_VPP_VPE_ENC_SCALE_PHASEY_STEP_ADDR A:0x1d0c038
y.create.l HWIO_VENUS0_VENUS_VPP_VPE_ENC_VC1_RANGE_ADDR A:0x1d0c03c
y.create.l HWIO_VENUS0_VENUS_VPP_VPE_ENC_OCMEM_BUF_CONFIG_ADDR A:0x1d0c040
y.create.l HWIO_VENUS0_VENUS_VPP_VPE_ENC_P0_OCMEM_EXTADDR_ADDR A:0x1d0c044
y.create.l HWIO_VENUS0_VENUS_VPP_VPE_ENC_P1_OCMEM_EXTADDR_ADDR A:0x1d0c048
y.create.l HWIO_VENUS0_VENUS_VPP_VPE_ENC_CYCLE_COUNT_ADDR A:0x1d0c050
y.create.l HWIO_VENUS0_VENUS_VPP_VPE_ENC_STEP_MODE_ADDR A:0x1d0c070
y.create.l HWIO_VENUS0_VENUS_VPP_VPE_ENC_CLOCK_CONFIG_ADDR A:0x1d0c074
y.create.l HWIO_VENUS0_VENUS_VPP_VPE_ENC_TESTBUS_SEL_ADDR A:0x1d0c078
y.create.l HWIO_VENUS0_VENUS_VPP_VPE_ENC_SPARE_REG_ADDR A:0x1d0c07c
y.create.l HWIO_VENUS0_VENUS_VPP_VPE_ENC_FETCH_CFG_ADDR A:0x1d0c080
y.create.l HWIO_VENUS0_VENUS_VPP_VPE_ENC_FETCH_STATS_ADDR A:0x1d0c084
y.create.l HWIO_VENUS0_VENUS_VPP_VPE_ENC_FETCH_COUNT_ADDR A:0x1d0c088
y.create.l HWIO_VENUS0_VENUS_VPP_VPE_ENC_MB_POS_ADDR A:0x1d0c08c
y.create.l HWIO_VENUS0_VENUS_VPP_VPE_ENC_DEINT_DECISION_ADDR A:0x1d0c090
y.create.l HWIO_VENUS0_VENUS_VPP_VPE_ENC_DEINT_COEFF0_ADDR A:0x1d0c094
y.create.l HWIO_VENUS0_VENUS_VPP_VPE_ENC_DEINT_COEFF1_ADDR A:0x1d0c098
y.create.l HWIO_VENUS0_VENUS_VPP_VPE_ENC_CSC_MV10_ADDR A:0x1d0c0a0
y.create.l HWIO_VENUS0_VENUS_VPP_VPE_ENC_CSC_MV11_ADDR A:0x1d0c0a4
y.create.l HWIO_VENUS0_VENUS_VPP_VPE_ENC_CSC_MV12_ADDR A:0x1d0c0a8
y.create.l HWIO_VENUS0_VENUS_VPP_VPE_ENC_CSC_MV13_ADDR A:0x1d0c0ac
y.create.l HWIO_VENUS0_VENUS_VPP_VPE_ENC_CSC_MV14_ADDR A:0x1d0c0b0
y.create.l HWIO_VENUS0_VENUS_VPP_VPE_ENC_CSC_MV15_ADDR A:0x1d0c0b4
y.create.l HWIO_VENUS0_VENUS_VPP_VPE_ENC_CSC_MV16_ADDR A:0x1d0c0b8
y.create.l HWIO_VENUS0_VENUS_VPP_VPE_ENC_CSC_MV17_ADDR A:0x1d0c0bc
y.create.l HWIO_VENUS0_VENUS_VPP_VPE_ENC_CSC_MV18_ADDR A:0x1d0c0c0
y.create.l HWIO_VENUS0_VENUS_VPP_VPE_ENC_CSC_PRE_BV10_ADDR A:0x1d0c0d0
y.create.l HWIO_VENUS0_VENUS_VPP_VPE_ENC_CSC_PRE_BV11_ADDR A:0x1d0c0d4
y.create.l HWIO_VENUS0_VENUS_VPP_VPE_ENC_CSC_PRE_BV12_ADDR A:0x1d0c0d8
y.create.l HWIO_VENUS0_VENUS_VPP_VPE_ENC_CSC_POST_BV10_ADDR A:0x1d0c0f0
y.create.l HWIO_VENUS0_VENUS_VPP_VPE_ENC_CSC_POST_BV11_ADDR A:0x1d0c0f4
y.create.l HWIO_VENUS0_VENUS_VPP_VPE_ENC_CSC_POST_BV12_ADDR A:0x1d0c0f8
y.create.l HWIO_VENUS0_VENUS_VPP_VPE_ENC_CSC_PRE_LV10_ADDR A:0x1d0c100
y.create.l HWIO_VENUS0_VENUS_VPP_VPE_ENC_CSC_PRE_LV11_ADDR A:0x1d0c104
y.create.l HWIO_VENUS0_VENUS_VPP_VPE_ENC_CSC_PRE_LV12_ADDR A:0x1d0c108
y.create.l HWIO_VENUS0_VENUS_VPP_VPE_ENC_CSC_PRE_LV13_ADDR A:0x1d0c10c
y.create.l HWIO_VENUS0_VENUS_VPP_VPE_ENC_CSC_PRE_LV14_ADDR A:0x1d0c110
y.create.l HWIO_VENUS0_VENUS_VPP_VPE_ENC_CSC_PRE_LV15_ADDR A:0x1d0c114
y.create.l HWIO_VENUS0_VENUS_VPP_VPE_ENC_CSC_POST_LV10_ADDR A:0x1d0c120
y.create.l HWIO_VENUS0_VENUS_VPP_VPE_ENC_CSC_POST_LV11_ADDR A:0x1d0c124
y.create.l HWIO_VENUS0_VENUS_VPP_VPE_ENC_CSC_POST_LV12_ADDR A:0x1d0c128
y.create.l HWIO_VENUS0_VENUS_VPP_VPE_ENC_CSC_POST_LV13_ADDR A:0x1d0c12c
y.create.l HWIO_VENUS0_VENUS_VPP_VPE_ENC_CSC_POST_LV14_ADDR A:0x1d0c130
y.create.l HWIO_VENUS0_VENUS_VPP_VPE_ENC_CSC_POST_LV15_ADDR A:0x1d0c134
y.create.l HWIO_VENUS0_VENUS_VPP_VPE_ENC_SPARE_0_ADDR A:0x1d0c138
y.create.l HWIO_VENUS0_VENUS_VPP_MVP_ENC_FRAME_CFG_ADDR A:0x1d0d000
y.create.l HWIO_VENUS0_VENUS_VPP_MVP_ENC_COLOCATED_CFG_ADDR A:0x1d0d004
y.create.l HWIO_VENUS0_VENUS_VPP_MVP_ENC_FRAME_SIZE_ADDR A:0x1d0d008
y.create.l HWIO_VENUS0_VENUS_VPP_MVP_ENC_SPAT_GMO_ADDR A:0x1d0d00c
y.create.l HWIO_VENUS0_VENUS_VPP_MVP_ENC_TEMP_GMO_ADDR A:0x1d0d010
y.create.l HWIO_VENUS0_VENUS_VPP_MVP_ENC_SEARCH_RANGE_MVX_ADDR A:0x1d0d014
y.create.l HWIO_VENUS0_VENUS_VPP_MVP_ENC_SEARCH_RANGE_MVY_ADDR A:0x1d0d018
y.create.l HWIO_VENUS0_VENUS_VPP_MVP_ENC_FRAME_BBOX_ADDR A:0x1d0d01c
y.create.l HWIO_VENUS0_VENUS_VPP_MVP_ENC_SPAT_MULT_FACTOR0_ADDR A:0x1d0d020
y.create.l HWIO_VENUS0_VENUS_VPP_MVP_ENC_SPAT_MULT_FACTOR1_ADDR A:0x1d0d024
y.create.l HWIO_VENUS0_VENUS_VPP_MVP_ENC_TEMP_MULT_FACTOR0_ADDR A:0x1d0d028
y.create.l HWIO_VENUS0_VENUS_VPP_MVP_ENC_TEMP_MULT_FACTOR1_ADDR A:0x1d0d02c
y.create.l HWIO_VENUS0_VENUS_VPP_MVP_ENC_TEMP_MULT_FACTOR2_ADDR A:0x1d0d030
y.create.l HWIO_VENUS0_VENUS_VPP_MVP_ENC_TEMP_MULT_FACTOR3_ADDR A:0x1d0d034
y.create.l HWIO_VENUS0_VENUS_VPP_MVP_ENC_HOR_BIN0_ADDR A:0x1d0d038
y.create.l HWIO_VENUS0_VENUS_VPP_MVP_ENC_HOR_BIN1_ADDR A:0x1d0d03c
y.create.l HWIO_VENUS0_VENUS_VPP_MVP_ENC_HOR_BIN2_ADDR A:0x1d0d040
y.create.l HWIO_VENUS0_VENUS_VPP_MVP_ENC_HOR_BIN3_ADDR A:0x1d0d044
y.create.l HWIO_VENUS0_VENUS_VPP_MVP_ENC_HOR_BIN4_ADDR A:0x1d0d048
y.create.l HWIO_VENUS0_VENUS_VPP_MVP_ENC_HOR_BIN5_ADDR A:0x1d0d04c
y.create.l HWIO_VENUS0_VENUS_VPP_MVP_ENC_HOR_BIN6_ADDR A:0x1d0d050
y.create.l HWIO_VENUS0_VENUS_VPP_MVP_ENC_HOR_BIN7_ADDR A:0x1d0d054
y.create.l HWIO_VENUS0_VENUS_VPP_MVP_ENC_HOR_BIN8_ADDR A:0x1d0d058
y.create.l HWIO_VENUS0_VENUS_VPP_MVP_ENC_HOR_BIN9_ADDR A:0x1d0d05c
y.create.l HWIO_VENUS0_VENUS_VPP_MVP_ENC_VER_BIN0_ADDR A:0x1d0d060
y.create.l HWIO_VENUS0_VENUS_VPP_MVP_ENC_VER_BIN1_ADDR A:0x1d0d064
y.create.l HWIO_VENUS0_VENUS_VPP_MVP_ENC_VER_BIN2_ADDR A:0x1d0d068
y.create.l HWIO_VENUS0_VENUS_VPP_MVP_ENC_VER_BIN3_ADDR A:0x1d0d06c
y.create.l HWIO_VENUS0_VENUS_VPP_MVP_ENC_VER_BIN4_ADDR A:0x1d0d070
y.create.l HWIO_VENUS0_VENUS_VPP_MVP_ENC_HOR_SUM_ADDR A:0x1d0d078
y.create.l HWIO_VENUS0_VENUS_VPP_MVP_ENC_VER_SUM_ADDR A:0x1d0d07c
y.create.l HWIO_VENUS0_VENUS_VPP_MVP_ENC_STAT_INTER_CNT_ADDR A:0x1d0d080
y.create.l HWIO_VENUS0_VENUS_VPP_MVP_ENC_STATUS_ADDR A:0x1d0d084
y.create.l HWIO_VENUS0_VENUS_VPP_MVP_ENC_TEST_BUS_SEL_ADDR A:0x1d0d088
y.create.l HWIO_VENUS0_VENUS_VPP_MVP_ENC_SPARE_ADDR A:0x1d0d08c
y.create.l HWIO_VENUS0_VENUS_VPP_MVP_ENC_DSR_ADDR A:0x1d0d090
y.create.l HWIO_VENUS0_VENUS_VPP_MVP_ENC_SPARE_1_ADDR A:0x1d0d094
y.create.l HWIO_VENUS0_VENUS_DMA_ENC_CONFIG_ADDR A:0x1d0f000
y.create.l HWIO_VENUS0_VENUS_DMA_ENC_FETCH_CFG_ADDR A:0x1d0f004
y.create.l HWIO_VENUS0_VENUS_DMA_ENC_DPB_CFG_ADDR A:0x1d0f008
y.create.l HWIO_VENUS0_VENUS_DMA_ENC_UBWC_STATUS_ADDR A:0x1d0f00c
y.create.l HWIO_VENUS0_VENUS_DMA_ENC_LB_DEST_ADDR A:0x1d0f080
y.create.l HWIO_VENUS0_VENUS_DMA_ENC_WB_REF_FRAME_SIZE_ADDR A:0x1d0f084
y.create.l HWIO_VENUS0_VENUS_DMA_ENC_REF_BYTES_PER_LINE_ADDR A:0x1d0f08c
y.create.l HWIO_VENUS0_VENUS_DMA_ENC_VSP_LB_DEST_ADDR A:0x1d0f090
y.create.l HWIO_VENUS0_VENUS_DMA_ENC_REF_CFG_ADDR A:0x1d0f100
y.create.l HWIO_VENUS0_VENUS_DMA_ENC_ROI_MB_OFFSET_ADDR A:0x1d0f104
y.create.l HWIO_VENUS0_VENUS_DMA_ENC_TILE_SIZE_CONFIG_ADDR A:0x1d0f10c
y.create.l HWIO_VENUS0_VENUS_DMA_ENC_REF_CYCLE_COUNT_ADDR A:0x1d0f120
y.create.l HWIO_VENUS0_VENUS_DMA_ENC_REF_OCMEM_BUF_CONFIG_ADDR A:0x1d0f128
y.create.l HWIO_VENUS0_VENUS_DMA_ENC_SUB_REF_RAM_CFG0_ADDR A:0x1d0f180
y.create.l HWIO_VENUS0_VENUS_DMA_ENC_SUB_REF_RAM_CFG1_ADDR A:0x1d0f184
y.create.l HWIO_VENUS0_VENUS_DMA_ENC_REF_FETCH_START_ADDR A:0x1d0f18c
y.create.l HWIO_VENUS0_VENUS_DMA_ENC_BUFF_START_ADDR0_ADDR A:0x1d0f200
y.create.l HWIO_VENUS0_VENUS_DMA_ENC_BUFF_START_ADDR1_ADDR A:0x1d0f204
y.create.l HWIO_VENUS0_VENUS_DMA_ENC_BUFF_START_ADDR2_ADDR A:0x1d0f208
y.create.l HWIO_VENUS0_VENUS_DMA_ENC_BUFF_START_ADDR3_ADDR A:0x1d0f20c
y.create.l HWIO_VENUS0_VENUS_DMA_ENC_BUFF_START_ADDR4_ADDR A:0x1d0f210
y.create.l HWIO_VENUS0_VENUS_DMA_ENC_BUFF_START_ADDR5_ADDR A:0x1d0f214
y.create.l HWIO_VENUS0_VENUS_DMA_ENC_BUFF_START_ADDR6_ADDR A:0x1d0f218
y.create.l HWIO_VENUS0_VENUS_DMA_ENC_BUFF_START_ADDR7_ADDR A:0x1d0f21c
y.create.l HWIO_VENUS0_VENUS_DMA_ENC_BUFF_START_ADDR8_ADDR A:0x1d0f220
y.create.l HWIO_VENUS0_VENUS_DMA_ENC_BUFF_START_ADDR9_ADDR A:0x1d0f224
y.create.l HWIO_VENUS0_VENUS_DMA_ENC_SDE_BIT_BUF_START_INIT_ADDR A:0x1d0f400
y.create.l HWIO_VENUS0_VENUS_DMA_ENC_SDE_BIT_BUF_START_ADDR_ADDR A:0x1d0f404
y.create.l HWIO_VENUS0_VENUS_DMA_ENC_SDE_BIN_BUF_START_INIT_ADDR A:0x1d0f408
y.create.l HWIO_VENUS0_VENUS_DMA_ENC_SDE_BIN_BUF_START_ADDR_ADDR A:0x1d0f40c
y.create.l HWIO_VENUS0_VENUS_DMA_ENC_SE_BIN_BUF_START_INIT_ADDR A:0x1d0f410
y.create.l HWIO_VENUS0_VENUS_DMA_ENC_SE_BIN_BUF_START_ADDR_ADDR A:0x1d0f414
y.create.l HWIO_VENUS0_VENUS_DMA_ENC_BUFF_SSID0_ADDR A:0x1d0f500
y.create.l HWIO_VENUS0_VENUS_DMA_ENC_BUFF_SSID1_ADDR A:0x1d0f504
y.create.l HWIO_VENUS0_VENUS_DMA_ENC_BUFF_SSID2_ADDR A:0x1d0f508
y.create.l HWIO_VENUS0_VENUS_DMA_ENC_BUFF_SSID3_ADDR A:0x1d0f50c
y.create.l HWIO_VENUS0_VENUS_DMA_ENC_BUFF_SSID4_ADDR A:0x1d0f510
y.create.l HWIO_VENUS0_VENUS_DMA_ENC_BUFF_SSID5_ADDR A:0x1d0f514
y.create.l HWIO_VENUS0_VENUS_DMA_ENC_BUFF_SSID6_ADDR A:0x1d0f518
y.create.l HWIO_VENUS0_VENUS_DMA_ENC_BUFF_SSID7_ADDR A:0x1d0f51c
y.create.l HWIO_VENUS0_VENUS_DMA_ENC_BUFF_SSID8_ADDR A:0x1d0f520
y.create.l HWIO_VENUS0_VENUS_DMA_ENC_BUFF_SSID9_ADDR A:0x1d0f524
y.create.l HWIO_VENUS0_VENUS_DMA_ENC_SPARE_0_ADDR A:0x1d0f580
y.create.l HWIO_VENUS0_VENUS_DMA_ENC_SPARE_1_ADDR A:0x1d0f584
y.create.l HWIO_VENUS0_VENUS_DMA_ENC_SPARE_2_ADDR A:0x1d0f588
y.create.l HWIO_VENUS0_VENUS_DMA_ENC_SPARE_3_ADDR A:0x1d0f58c
y.create.l HWIO_VENUS0_VENUS_DMA_ENC_SPARE_4_ADDR A:0x1d0f590
y.create.l HWIO_VENUS0_VENUS_DMA_ENC_SPARE_5_ADDR A:0x1d0f594
y.create.l HWIO_VENUS0_VENUS_DMA_ENC_SPARE_6_ADDR A:0x1d0f598
y.create.l HWIO_VENUS0_VENUS_DMA_ENC_SPARE_7_ADDR A:0x1d0f59c
y.create.l HWIO_VENUS0_VENUS_SS_DEC_INTR_STATUS_ADDR A:0x1d30000
y.create.l HWIO_VENUS0_VENUS_SS_DEC_INTR_MASK_ADDR A:0x1d30004
y.create.l HWIO_VENUS0_VENUS_SS_DEC_SPARE_0_ADDR A:0x1d30008
y.create.l HWIO_VENUS0_VENUS_SS_DEC_CLOCK_HALT_ADDR A:0x1d3000c
y.create.l HWIO_VENUS0_VENUS_SS_DEC_SPARE_1_ADDR A:0x1d30010
y.create.l HWIO_VENUS0_VENUS_SS_DEC_WDLOAD0_ADDR A:0x1d30014
y.create.l HWIO_VENUS0_VENUS_SS_DEC_WDLOAD1_ADDR A:0x1d30018
y.create.l HWIO_VENUS0_VENUS_SS_DEC_WDLOAD2_ADDR A:0x1d3001c
y.create.l HWIO_VENUS0_VENUS_SS_DEC_WDLOAD3_ADDR A:0x1d30020
y.create.l HWIO_VENUS0_VENUS_SS_DEC_WDVALUE0_ADDR A:0x1d30024
y.create.l HWIO_VENUS0_VENUS_SS_DEC_WDVALUE1_ADDR A:0x1d30028
y.create.l HWIO_VENUS0_VENUS_SS_DEC_WDVALUE2_ADDR A:0x1d3002c
y.create.l HWIO_VENUS0_VENUS_SS_DEC_WDVALUE3_ADDR A:0x1d30030
y.create.l HWIO_VENUS0_VENUS_SS_DEC_WD_IRQ_STATUS_ADDR A:0x1d30034
y.create.l HWIO_VENUS0_VENUS_SS_DEC_WD_IRQ_MASK_ADDR A:0x1d30038
y.create.l HWIO_VENUS0_VENUS_SS_DEC_WD_IRQ_CLEAR_ADDR A:0x1d3003c
y.create.l HWIO_VENUS0_VENUS_SS_DEC_CLOCK_EN_ADDR A:0x1d30040
y.create.l HWIO_VENUS0_VENUS_SS_DEC_SW_RESET_ADDR A:0x1d30044
y.create.l HWIO_VENUS0_VENUS_SS_DEC_SPARE_2_ADDR A:0x1d30048
y.create.l HWIO_VENUS0_VENUS_VSP_TOP_DEC_STATUS_ADDR A:0x1d31000
y.create.l HWIO_VENUS0_VENUS_VSP_TOP_DEC_MASK_ADDR A:0x1d31004
y.create.l HWIO_VENUS0_VENUS_VSP_TOP_DEC_SPARE_0_ADDR A:0x1d31008
y.create.l HWIO_VENUS0_VENUS_VSP_TOP_DEC_SPARE_1_ADDR A:0x1d3100c
y.create.l HWIO_VENUS0_VENUS_VSP_TOP_DEC_SPARE_2_ADDR A:0x1d31010
y.create.l HWIO_VENUS0_VENUS_VSP_TOP_DEC_SDE_CP_STATUS_ADDR A:0x1d31014
y.create.l HWIO_VENUS0_VENUS_VSP_CCE_DEC_CMD_ADDR A:0x1d32000
y.create.l HWIO_VENUS0_VENUS_VSP_CCE_DEC_RESULT_ADDR A:0x1d32004
y.create.l HWIO_VENUS0_VENUS_VSP_CCE_DEC_CONFIG_WPT_ADDR A:0x1d3200c
y.create.l HWIO_VENUS0_VENUS_VSP_CCE_DEC_BS_BUF_SIZE_ADDR A:0x1d32010
y.create.l HWIO_VENUS0_VENUS_VSP_CCE_DEC_FIFO_ICH_CONFIG_ADDR A:0x1d32014
y.create.l HWIO_VENUS0_VENUS_VSP_CCE_DEC_BS_READ_OFFSET_ADDR A:0x1d32018
y.create.l HWIO_VENUS0_VENUS_VSP_CCE_DEC_BS_SEG_LEN_ADDR A:0x1d3201c
y.create.l HWIO_VENUS0_VENUS_VSP_CCE_DEC_BS_BIT_OFFSET_ADDR A:0x1d32020
y.create.l HWIO_VENUS0_VENUS_VSP_CCE_DEC_BS_ICH_START_ADDR A:0x1d32024
y.create.l HWIO_VENUS0_VENUS_VSP_CCE_DEC_BS_ICH_STATUS_ADDR A:0x1d32028
y.create.l HWIO_VENUS0_VENUS_VSP_CCE_DEC_BS_ICH_RESET_ADDR A:0x1d3202c
y.create.l HWIO_VENUS0_VENUS_VSP_CCE_DEC_BS_BIT_COUNT_ADDR A:0x1d32030
y.create.l HWIO_VENUS0_VENUS_VSP_CCE_DEC_BS_EPC_COUNT_ADDR A:0x1d32034
y.create.l HWIO_VENUS0_VENUS_VSP_CCE_DEC_BPD_CONFIG1_ADDR A:0x1d32038
y.create.l HWIO_VENUS0_VENUS_VSP_CCE_DEC_BPD_CONFIG2_ADDR A:0x1d3203c
y.create.l HWIO_VENUS0_VENUS_VSP_CCE_DEC_BPD_CONFIG3_ADDR A:0x1d32040
y.create.l HWIO_VENUS0_VENUS_VSP_CCE_DEC_BPD_STATUS_ADDR A:0x1d32044
y.create.l HWIO_VENUS0_VENUS_VSP_CCE_DEC_VP8_HEADER_STATUS_ADDR A:0x1d32048
y.create.l HWIO_VENUS0_VENUS_VSP_CCE_DEC_VP8_KEY_FRAME_SIZE_STATUS_ADDR A:0x1d3204c
y.create.l HWIO_VENUS0_VENUS_VSP_CCE_DEC_VP9_HEADER_STATUS_ADDR A:0x1d32050
y.create.l HWIO_VENUS0_VENUS_VSP_CCE_DEC_VP9_HEADER_NONINTRA_STATUS_ADDR A:0x1d32054
y.create.l HWIO_VENUS0_VENUS_VSP_CCE_DEC_VP9_FRAME_SIZE_STATUS_ADDR A:0x1d32058
y.create.l HWIO_VENUS0_VENUS_VSP_CCE_DEC_VP9_DISP_FRAME_SIZE_STATUS_ADDR A:0x1d3205c
y.create.l HWIO_VENUS0_VENUS_VSP_CCE_DEC_CP_CODEC_CONFIG_ADDR A:0x1d32060
y.create.l HWIO_VENUS0_VENUS_VSP_CCE_DEC_CP_DMA_RD_OFFSET_ADDR A:0x1d32064
y.create.l HWIO_VENUS0_VENUS_VSP_CCE_DEC_CP_DMA_WR_OFFSET_ADDR A:0x1d32068
y.create.l HWIO_VENUS0_VENUS_VSP_CCE_DEC_CP_DMA_SIZE_ADDR A:0x1d3206c
y.create.l HWIO_VENUS0_VENUS_VSP_CCE_DEC_CP_SC_SUFFIX_ADDR A:0x1d32070
y.create.l HWIO_VENUS0_VENUS_VSP_CCE_DEC_FIFO_STATUS_ADDR A:0x1d32074
y.create.l HWIO_VENUS0_VENUS_VSP_CCE_DEC_CMD_STATUS_ADDR A:0x1d32078
y.create.l HWIO_VENUS0_VENUS_VSP_CCE_DEC_CMD_STATUS_CLEAR_ADDR A:0x1d3207c
y.create.l HWIO_VENUS0_VENUS_VSP_CCE_DEC_CMD_IRQ_MASK_ADDR A:0x1d32080
y.create.l HWIO_VENUS0_VENUS_VSP_CCE_DEC_CMD_RSLT_QUEUE_TIMEOUT_CFG_ADDR A:0x1d32084
y.create.l HWIO_VENUS0_VENUS_VSP_CCE_DEC_CMD_TEST_BUS_CONTROL_ADDR A:0x1d32088
y.create.l HWIO_VENUS0_VENUS_VSP_CCE_DEC_CMD_TEST_BUS_REGISTER_ADDR A:0x1d3208c
y.create.l HWIO_VENUS0_VENUS_VSP_CCE_DEC_SW_RESET_ADDR A:0x1d32090
y.create.l HWIO_VENUS0_VENUS_VSP_CCE_DEC_SCS_CMD_ADDR A:0x1d320a0
y.create.l HWIO_VENUS0_VENUS_VSP_CCE_DEC_SCS_BS_BUF_SIZE_ADDR A:0x1d320a4
y.create.l HWIO_VENUS0_VENUS_VSP_CCE_DEC_SCS_FIFO_ICH_CONFIG_ADDR A:0x1d320a8
y.create.l HWIO_VENUS0_VENUS_VSP_CCE_DEC_SCS_BS_READ_OFFSET_ADDR A:0x1d320ac
y.create.l HWIO_VENUS0_VENUS_VSP_CCE_DEC_SCS_BS_SEG_LEN_ADDR A:0x1d320b0
y.create.l HWIO_VENUS0_VENUS_VSP_CCE_DEC_SCS_BS_WR_SEG_LEN_ADDR A:0x1d320b4
y.create.l HWIO_VENUS0_VENUS_VSP_CCE_DEC_SCS_BS_ICH_START_ADDR A:0x1d320b8
y.create.l HWIO_VENUS0_VENUS_VSP_CCE_DEC_SCS_BS_ICH_STATUS_ADDR A:0x1d320bc
y.create.l HWIO_VENUS0_VENUS_VSP_CCE_DEC_SCS_BS_ICH_RESET_ADDR A:0x1d320c0
y.create.l HWIO_VENUS0_VENUS_VSP_CCE_DEC_SCS_BS_BIT_COUNT_ADDR A:0x1d320c4
y.create.l HWIO_VENUS0_VENUS_VSP_CCE_DEC_SCS_CMD_STATUS_ADDR A:0x1d320c8
y.create.l HWIO_VENUS0_VENUS_VSP_CCE_DEC_SCS_CMD_STATUS_CLEAR_ADDR A:0x1d320cc
y.create.l HWIO_VENUS0_VENUS_VSP_CCE_DEC_SCS_CMD_IRQ_MASK_ADDR A:0x1d320d0
y.create.l HWIO_VENUS0_VENUS_VSP_CCE_DEC_SCS_CMD_TEST_BUS_CONTROL_ADDR A:0x1d320d4
y.create.l HWIO_VENUS0_VENUS_VSP_CCE_DEC_SCS_CMD_TEST_BUS_REGISTER_ADDR A:0x1d320d8
y.create.l HWIO_VENUS0_VENUS_VSP_CCE_DEC_SCS_SW_RESET_ADDR A:0x1d320dc
y.create.l HWIO_VENUS0_VENUS_VSP_CCE_DEC_SPARE_0_ADDR A:0x1d320e0
y.create.l HWIO_VENUS0_VENUS_VSP_SDE_DEC_TOP_CODEC_CONFIG_ADDR A:0x1d33000
y.create.l HWIO_VENUS0_VENUS_VSP_SDE_DEC_TOP_FIFO_ICH_CONFIG_ADDR A:0x1d33004
y.create.l HWIO_VENUS0_VENUS_VSP_SDE_DEC_TOP_BIN_BUF_CFG_ADDR A:0x1d33008
y.create.l HWIO_VENUS0_VENUS_VSP_SDE_DEC_TOP_SW_RESET_ADDR A:0x1d3300c
y.create.l HWIO_VENUS0_VENUS_VSP_SDE_DEC_TOP_BIN_BUF_WR_OFFSET0_ADDR A:0x1d33010
y.create.l HWIO_VENUS0_VENUS_VSP_SDE_DEC_TOP_BIN_BUF_WR_OFFSET1_ADDR A:0x1d33014
y.create.l HWIO_VENUS0_VENUS_VSP_SDE_DEC_TOP_BIN_BUF_WR_OFFSET2_ADDR A:0x1d33018
y.create.l HWIO_VENUS0_VENUS_VSP_SDE_DEC_TOP_BIN_BUF_WR_OFFSET3_ADDR A:0x1d3301c
y.create.l HWIO_VENUS0_VENUS_VSP_SDE_DEC_TOP_BIN_BUF_SIZE0_ADDR A:0x1d33020
y.create.l HWIO_VENUS0_VENUS_VSP_SDE_DEC_TOP_BIN_BUF_SIZE1_ADDR A:0x1d33024
y.create.l HWIO_VENUS0_VENUS_VSP_SDE_DEC_TOP_BIN_BUF_SIZE2_ADDR A:0x1d33028
y.create.l HWIO_VENUS0_VENUS_VSP_SDE_DEC_TOP_BIN_BUF_SIZE3_ADDR A:0x1d3302c
y.create.l HWIO_VENUS0_VENUS_VSP_SDE_DEC_TOP_BIT_BUF_SIZE_ADDR A:0x1d33030
y.create.l HWIO_VENUS0_VENUS_VSP_SDE_DEC_TOP_SLICE_CMD_RD_OFFSET_ADDR A:0x1d33034
y.create.l HWIO_VENUS0_VENUS_VSP_SDE_DEC_TOP_SLICE_CMD_BUF_SIZE_ADDR A:0x1d33038
y.create.l HWIO_VENUS0_VENUS_VSP_SDE_DEC_TOP_PIC_DIMENSION_ADDR A:0x1d3303c
y.create.l HWIO_VENUS0_VENUS_VSP_SDE_DEC_TOP_BIN_CNT0_ADDR A:0x1d33040
y.create.l HWIO_VENUS0_VENUS_VSP_SDE_DEC_TOP_BIN_CNT1_ADDR A:0x1d33044
y.create.l HWIO_VENUS0_VENUS_VSP_SDE_DEC_TOP_BIN_CNT2_ADDR A:0x1d33048
y.create.l HWIO_VENUS0_VENUS_VSP_SDE_DEC_TOP_BIN_CNT3_ADDR A:0x1d3304c
y.create.l HWIO_VENUS0_VENUS_VSP_SDE_DEC_TOP_BIT_CNT_ADDR A:0x1d33050
y.create.l HWIO_VENUS0_VENUS_VSP_SDE_DEC_TOP_BIN_EPC_CNT0_ADDR A:0x1d33054
y.create.l HWIO_VENUS0_VENUS_VSP_SDE_DEC_TOP_BIN_EPC_CNT1_ADDR A:0x1d33058
y.create.l HWIO_VENUS0_VENUS_VSP_SDE_DEC_TOP_BIN_EPC_CNT2_ADDR A:0x1d3305c
y.create.l HWIO_VENUS0_VENUS_VSP_SDE_DEC_TOP_BIN_EPC_CNT3_ADDR A:0x1d33060
y.create.l HWIO_VENUS0_VENUS_VSP_SDE_DEC_TOP_BIT_EPC_CNT_ADDR A:0x1d33064
y.create.l HWIO_VENUS0_VENUS_VSP_SDE_DEC_TOP_MB_POS_ADDR A:0x1d33068
y.create.l HWIO_VENUS0_VENUS_VSP_SDE_DEC_TOP_ERR_STATUS_ADDR A:0x1d3306c
y.create.l HWIO_VENUS0_VENUS_VSP_SDE_DEC_TOP_TEST_BUS_CONTROL_ADDR A:0x1d33070
y.create.l HWIO_VENUS0_VENUS_VSP_SDE_DEC_TOP_TEST_BUS_REGISTER_ADDR A:0x1d33074
y.create.l HWIO_VENUS0_VENUS_VSP_SDE_DEC_TOP_SPARE_ADDR A:0x1d33078
y.create.l HWIO_VENUS0_VENUS_VSP_SDE_DEC_TOP_SINGLE_STEP_CONTROL_ADDR A:0x1d3307c
y.create.l HWIO_VENUS0_VENUS_VSP_SDE_DEC_H265D_CFG1_ADDR A:0x1d33080
y.create.l HWIO_VENUS0_VENUS_VSP_SDE_DEC_H265D_CFG2_ADDR A:0x1d33084
y.create.l HWIO_VENUS0_VENUS_VSP_SDE_DEC_H265D_CFG3_ADDR A:0x1d33088
y.create.l HWIO_VENUS0_VENUS_VSP_SDE_DEC_H265D_CFG4_ADDR A:0x1d3308c
y.create.l HWIO_VENUS0_VENUS_VSP_SDE_DEC_H265D_TILE_INIT_ADDR A:0x1d33090
y.create.l HWIO_VENUS0_VENUS_VSP_SDE_DEC_H265D_TILE_X_ADDR A:0x1d33094
y.create.l HWIO_VENUS0_VENUS_VSP_SDE_DEC_H265D_TILE_Y_ADDR A:0x1d33098
y.create.l HWIO_VENUS0_VENUS_VSP_SDE_DEC_H265D_PCM_ADDR A:0x1d3309c
y.create.l HWIO_VENUS0_VENUS_VSP_SDE_DEC_H265D_STATUS_ADDR A:0x1d330a0
y.create.l HWIO_VENUS0_VENUS_VSP_SDE_DEC_H265D_STATUS_CLEAR_ADDR A:0x1d330a4
y.create.l HWIO_VENUS0_VENUS_VSP_SDE_DEC_H265D_STATUS_MASK_ADDR A:0x1d330a8
y.create.l HWIO_VENUS0_VENUS_VSP_SDE_DEC_H264D_PIC_CFG_ADDR A:0x1d330c0
y.create.l HWIO_VENUS0_VENUS_VSP_SDE_DEC_H264D_IRQ_STATUS_ADDR A:0x1d330c4
y.create.l HWIO_VENUS0_VENUS_VSP_SDE_DEC_H264D_IRQ_MASK_ADDR A:0x1d330c8
y.create.l HWIO_VENUS0_VENUS_VSP_SDE_DEC_H264D_IRQ_CLEAR_ADDR A:0x1d330cc
y.create.l HWIO_VENUS0_VENUS_VSP_SDE_DEC_VP9_CFG_0_ADDR A:0x1d330e0
y.create.l HWIO_VENUS0_VENUS_VSP_SDE_DEC_VPX_CFG_1_ADDR A:0x1d330e4
y.create.l HWIO_VENUS0_VENUS_VSP_SDE_DEC_VPXA_IRQ_STATUS_ADDR A:0x1d330e8
y.create.l HWIO_VENUS0_VENUS_VSP_SDE_DEC_VPXA_IRQ_STATUS_CLEAR_ADDR A:0x1d330ec
y.create.l HWIO_VENUS0_VENUS_VSP_SDE_DEC_VPXA_IRQ_MASK_ADDR A:0x1d330f0
y.create.l HWIO_VENUS0_VENUS_VSP_SDE_DEC_VPX_FRAME_HEADER_BIT_CNT_ADDR A:0x1d330f4
y.create.l HWIO_VENUS0_VENUS_VSP_SDE_DEC_VPX_BITSTREAM_BUF_SIZE_ADDR A:0x1d330f8
y.create.l HWIO_VENUS0_VENUS_VSP_SDE_DEC_SPARE_0_ADDR A:0x1d330fc
y.create.l HWIO_VENUS0_VENUS_VPP_TOP_DEC_STATUS_ADDR A:0x1d34000
y.create.l HWIO_VENUS0_VENUS_VPP_TOP_DEC_MASK_ADDR A:0x1d34004
y.create.l HWIO_VENUS0_VENUS_VPP_TOP_DEC_SPARE_0_ADDR A:0x1d34008
y.create.l HWIO_VENUS0_VENUS_VPP_TOP_DEC_SPARE_1_ADDR A:0x1d34010
y.create.l HWIO_VENUS0_VENUS_VPP_TOP_DEC_SPARE_2_ADDR A:0x1d34014
y.create.l HWIO_VENUS0_VENUS_VPP_TOP_DEC_SPARE_3_ADDR A:0x1d34018
y.create.l HWIO_VENUS0_VENUS_VPP_TOP_DEC_SE_CP_STATUS_ADDR A:0x1d3401c
y.create.l HWIO_VENUS0_VENUS_VPP_SE_DEC_TOP_PIC_SIZE_IN_SAMPLES_ADDR A:0x1d35000
y.create.l HWIO_VENUS0_VENUS_VPP_SE_DEC_TOP_OPMODE_CONFIG_ADDR A:0x1d35004
y.create.l HWIO_VENUS0_VENUS_VPP_SE_DEC_FIFO_CONFIG_ADDR A:0x1d35008
y.create.l HWIO_VENUS0_VENUS_VPP_SE_DEC_TOP_BIN_READ_OFFSET_HDR_ADDR A:0x1d3500c
y.create.l HWIO_VENUS0_VENUS_VPP_SE_DEC_TOP_BIN_READ_OFFSET_RES_ADDR A:0x1d35010
y.create.l HWIO_VENUS0_VENUS_VPP_SE_DEC_TOP_SKIP_BITS_HDR_ADDR A:0x1d35014
y.create.l HWIO_VENUS0_VENUS_VPP_SE_DEC_TOP_SKIP_BITS_RES_ADDR A:0x1d35018
y.create.l HWIO_VENUS0_VENUS_VPP_SE_DEC_TOP_BIN_BUFFER_SIZE_HDR_ADDR A:0x1d3501c
y.create.l HWIO_VENUS0_VENUS_VPP_SE_DEC_TOP_BIN_BUFFER_SIZE_RES_ADDR A:0x1d35020
y.create.l HWIO_VENUS0_VENUS_VPP_SE_DEC_TOP_BIN_BUFFER_SEG_LEN_HDR_ADDR A:0x1d35024
y.create.l HWIO_VENUS0_VENUS_VPP_SE_DEC_TOP_BIN_BUFFER_SEG_LEN_RES_ADDR A:0x1d35028
y.create.l HWIO_VENUS0_VENUS_VPP_SE_DEC_TOP_BS_BIT_COUNT_HDR_ADDR A:0x1d3502c
y.create.l HWIO_VENUS0_VENUS_VPP_SE_DEC_TOP_BS_BIT_COUNT_RES_ADDR A:0x1d35030
y.create.l HWIO_VENUS0_VENUS_VPP_SE_DEC_TOP_BS_EPC_COUNT_HDR_ADDR A:0x1d35034
y.create.l HWIO_VENUS0_VENUS_VPP_SE_DEC_TOP_BS_EPC_COUNT_RES_ADDR A:0x1d35038
y.create.l HWIO_VENUS0_VENUS_VPP_SE_DEC_TOP_SLICE_CMD_RD_OFFSET_ADDR A:0x1d3503c
y.create.l HWIO_VENUS0_VENUS_VPP_SE_DEC_TOP_SLICE_CMD_BUF_SIZE_ADDR A:0x1d35040
y.create.l HWIO_VENUS0_VENUS_VPP_SE_DEC_TOP_PIC_SIZE_IN_PIXELS_ADDR A:0x1d35044
y.create.l HWIO_VENUS0_VENUS_VPP_SE_DEC_TOP_SPARE_0_ADDR A:0x1d35048
y.create.l HWIO_VENUS0_VENUS_VPP_SE_DEC_TOP_SW_RESET_ADDR A:0x1d3504c
y.create.l HWIO_VENUS0_VENUS_VPP_SE_DEC_TOP_MVE_POC_TOP_ADDR A:0x1d35050
y.create.l HWIO_VENUS0_VENUS_VPP_SE_DEC_TOP_MVE_POC_BOTTOM_ADDR A:0x1d35054
y.create.l HWIO_VENUS0_VENUS_VPP_SE_DEC_TOP_LT_REF_PIC_ADDR A:0x1d35058
y.create.l HWIO_VENUS0_VENUS_VPP_SE_DEC_TOP_CURR_FRAME_POC_ADDR A:0x1d3505c
y.create.l HWIO_VENUS0_VENUS_VPP_SE_DEC_TOP_COL_TO_LIST0_MAP_0_ADDR A:0x1d35060
y.create.l HWIO_VENUS0_VENUS_VPP_SE_DEC_TOP_COL_TO_LIST0_MAP_1_ADDR A:0x1d35064
y.create.l HWIO_VENUS0_VENUS_VPP_SE_DEC_TOP_COL_TO_LIST0_MAP_2_ADDR A:0x1d35068
y.create.l HWIO_VENUS0_VENUS_VPP_SE_DEC_TOP_SUM_QP_ADDR A:0x1d3506c
y.create.l HWIO_VENUS0_VENUS_VPP_SE_DEC_TOP_SUM_QP_COUNT_ADDR A:0x1d35070
y.create.l HWIO_VENUS0_VENUS_VPP_SE_DEC_TOP_SPARE_1_ADDR A:0x1d35074
y.create.l HWIO_VENUS0_VENUS_VPP_SE_DEC_TOP_REF_POC0_ADDR A:0x1d35078
y.create.l HWIO_VENUS0_VENUS_VPP_SE_DEC_TOP_REF_POC1_ADDR A:0x1d3507c
y.create.l HWIO_VENUS0_VENUS_VPP_SE_DEC_TOP_REF_POC2_ADDR A:0x1d35080
y.create.l HWIO_VENUS0_VENUS_VPP_SE_DEC_TOP_REF_POC3_ADDR A:0x1d35084
y.create.l HWIO_VENUS0_VENUS_VPP_SE_DEC_TOP_REF_POC4_ADDR A:0x1d35088
y.create.l HWIO_VENUS0_VENUS_VPP_SE_DEC_TOP_REF_POC5_ADDR A:0x1d3508c
y.create.l HWIO_VENUS0_VENUS_VPP_SE_DEC_TOP_REF_POC6_ADDR A:0x1d35090
y.create.l HWIO_VENUS0_VENUS_VPP_SE_DEC_TOP_REF_POC7_ADDR A:0x1d35094
y.create.l HWIO_VENUS0_VENUS_VPP_SE_DEC_TOP_REF_POC8_ADDR A:0x1d35098
y.create.l HWIO_VENUS0_VENUS_VPP_SE_DEC_TOP_REF_POC9_ADDR A:0x1d3509c
y.create.l HWIO_VENUS0_VENUS_VPP_SE_DEC_TOP_SCALING_LIST_4X4_CFG_ADDR A:0x1d350f8
y.create.l HWIO_VENUS0_VENUS_VPP_SE_DEC_TOP_SCALING_LIST_8X8_CFG_ADDR A:0x1d350fc
y.create.l HWIO_VENUS0_VENUS_VPP_SE_DEC_TOP_SCALING_LIST_16X16_32X32_CFG_ADDR A:0x1d35100
y.create.l HWIO_VENUS0_VENUS_VPP_SE_DEC_TOP_TILE_INIT_ADDR A:0x1d35104
y.create.l HWIO_VENUS0_VENUS_VPP_SE_DEC_TOP_TILE_POS_X_ADDR A:0x1d35108
y.create.l HWIO_VENUS0_VENUS_VPP_SE_DEC_TOP_TILE_POS_Y_ADDR A:0x1d3510c
y.create.l HWIO_VENUS0_VENUS_VPP_SE_DEC_TOP_ERR_CFG_ADDR A:0x1d35110
y.create.l HWIO_VENUS0_VENUS_VPP_SE_DEC_TOP_ERR_STATUS_ADDR A:0x1d35114
y.create.l HWIO_VENUS0_VENUS_VPP_SE_DEC_TOP_IRQ_STATUS_ADDR A:0x1d35118
y.create.l HWIO_VENUS0_VENUS_VPP_SE_DEC_TOP_STATUS_CLEAR_ADDR A:0x1d3511c
y.create.l HWIO_VENUS0_VENUS_VPP_SE_DEC_TOP_IRQ_MASK_ADDR A:0x1d35120
y.create.l HWIO_VENUS0_VENUS_VPP_SE_DEC_TOP_MB_POS_INFO_1_ADDR A:0x1d35124
y.create.l HWIO_VENUS0_VENUS_VPP_SE_DEC_TOP_MB_POS_INFO_2_ADDR A:0x1d35128
y.create.l HWIO_VENUS0_VENUS_VPP_SE_DEC_TOP_TEST_BUS_CONTROL_ADDR A:0x1d3512c
y.create.l HWIO_VENUS0_VENUS_VPP_SE_DEC_TOP_TEST_BUS_REGISTER_ADDR A:0x1d35130
y.create.l HWIO_VENUS0_VENUS_VPP_SE_DEC_TOP_DEBUG_CFG_ADDR A:0x1d35134
y.create.l HWIO_VENUS0_VENUS_VPP_SE_DEC_TOP_DEBUG_FLUSH_STATUS_ADDR A:0x1d35138
y.create.l HWIO_VENUS0_VENUS_VPP_SE_DEC_TOP_MISR_SPARE0_ADDR A:0x1d3513c
y.create.l HWIO_VENUS0_VENUS_VPP_SE_DEC_TOP_MISR_SPARE1_ADDR A:0x1d35140
y.create.l HWIO_VENUS0_VENUS_VPP_SE_DEC_TOP_MISR_SPARE2_ADDR A:0x1d35144
y.create.l HWIO_VENUS0_VENUS_VPP_SE_DEC_TOP_MISR_SPARE3_ADDR A:0x1d35148
y.create.l HWIO_VENUS0_VENUS_VPP_SE_DEC_TOP_MISR_SPARE4_ADDR A:0x1d3514c
y.create.l HWIO_VENUS0_VENUS_VPP_SE_DEC_TOP_MISR_SPARE5_ADDR A:0x1d35150
y.create.l HWIO_VENUS0_VENUS_VPP_SE_DEC_TOP_MISR_SPARE6_ADDR A:0x1d35154
y.create.l HWIO_VENUS0_VENUS_VPP_SE_DEC_TOP_MISR_SPARE7_ADDR A:0x1d35158
y.create.l HWIO_VENUS0_VENUS_VPP_SE_DEC_TOP_MISR_SPARE8_ADDR A:0x1d3515c
y.create.l HWIO_VENUS0_VENUS_VPP_SE_DEC_TOP_MISR_SPARE9_ADDR A:0x1d35160
y.create.l HWIO_VENUS0_VENUS_VPP_SE_DEC_TOP_SINGLE_STEP_CONTROL_ADDR A:0x1d35168
y.create.l HWIO_VENUS0_VENUS_VPP_SE_DEC_TOP_COL_ADDR_ADDR A:0x1d3516c
y.create.l HWIO_VENUS0_VENUS_VPP_SE_DEC_H265D_CONFIG1_ADDR A:0x1d35200
y.create.l HWIO_VENUS0_VENUS_VPP_SE_DEC_H265D_CONFIG2_ADDR A:0x1d35204
y.create.l HWIO_VENUS0_VENUS_VPP_SE_DEC_H265D_CONFIG3_ADDR A:0x1d35208
y.create.l HWIO_VENUS0_VENUS_VPP_SE_DEC_H265D_CONFIG4_ADDR A:0x1d3520c
y.create.l HWIO_VENUS0_VENUS_VPP_SE_DEC_VC1D_PIC_INFO_ADDR A:0x1d35300
y.create.l HWIO_VENUS0_VENUS_VPP_SE_DEC_VC1D_PIC_TBL_IDX_ADDR A:0x1d35304
y.create.l HWIO_VENUS0_VENUS_VPP_SE_DEC_VC1D_PIC_QUANT_ADDR A:0x1d35308
y.create.l HWIO_VENUS0_VENUS_VPP_SE_DEC_VC1D_PIC_MV_PARAMS_ADDR A:0x1d3530c
y.create.l HWIO_VENUS0_VENUS_VSP_SE_VC1D_PIC_INFO_BITS_ADDR A:0x1d35400
y.create.l HWIO_VENUS0_VENUS_VSP_SE_VC1D_FIELD_INFO_BITS_ADDR A:0x1d35404
y.create.l HWIO_VENUS0_VENUS_VSP_SE_VC1D_BPD_INFO_ADDR A:0x1d35408
y.create.l HWIO_VENUS0_VENUS_VSP_SE_VC1D_BPD_INFO_2_ADDR A:0x1d3540c
y.create.l HWIO_VENUS0_VENUS_VPP_SE_DEC_H264D_SE_CONFIG_ADDR A:0x1d35410
y.create.l HWIO_VENUS0_VENUS_VPP_SE_DEC_MPEG2D_SE_CONFIG_ADDR A:0x1d35500
y.create.l HWIO_VENUS0_VENUS_VPP_SE_DEC_311D_PIC_INFO_ADDR A:0x1d35504
y.create.l HWIO_VENUS0_VENUS_VPP_SE_DEC_MP4D_PIC_INFO_ADDR A:0x1d35508
y.create.l HWIO_VENUS0_VENUS_VPP_SE_DEC_MP4D_COLOCATED0_ADDR A:0x1d3550c
y.create.l HWIO_VENUS0_VENUS_VPP_SE_DEC_MP4D_COLOCATED1_ADDR A:0x1d35600
y.create.l HWIO_VENUS0_VENUS_VPP_SE_DEC_MP4D_COLOCATED2_ADDR A:0x1d35604
y.create.l HWIO_VENUS0_VENUS_VPP_SE_DEC_MP4D_COLOCATED3_ADDR A:0x1d35608
y.create.l HWIO_VENUS0_VENUS_VPP_SE_DEC_MP4D_BITS_ADDR A:0x1d3560c
y.create.l HWIO_VENUS0_VENUS_VPP_SE_DEC_H263D_GOB_INFO_ADDR A:0x1d35700
y.create.l HWIO_VENUS0_VENUS_VPP_SE_DEC_VP9_CFG_0_ADDR A:0x1d35704
y.create.l HWIO_VENUS0_VENUS_VPP_SE_DEC_VPX_SLF0_ADDR A:0x1d35708
y.create.l HWIO_VENUS0_VENUS_VPP_SE_DEC_VPX_SLF1_ADDR A:0x1d3570c
y.create.l HWIO_VENUS0_VENUS_VPP_SE_DEC_VPX_SLF2_ADDR A:0x1d35710
y.create.l HWIO_VENUS0_VENUS_VPP_SE_DEC_VPX_SLF3_ADDR A:0x1d35714
y.create.l HWIO_VENUS0_VENUS_VPP_SE_DEC_VPX_SLF4_ADDR A:0x1d35718
y.create.l HWIO_VENUS0_VENUS_VPP_SE_DEC_VPX_SLF5_ADDR A:0x1d3571c
y.create.l HWIO_VENUS0_VENUS_VPP_SE_DEC_VPX_SLF6_ADDR A:0x1d35720
y.create.l HWIO_VENUS0_VENUS_VPP_SE_DEC_VPX_SLF7_ADDR A:0x1d35724
y.create.l HWIO_VENUS0_VENUS_VPP_SE_DEC_VPX_SLF_READ0_ADDR A:0x1d35728
y.create.l HWIO_VENUS0_VENUS_VPP_SE_DEC_VPX_SLF_READ1_ADDR A:0x1d3572c
y.create.l HWIO_VENUS0_VENUS_VPP_SE_DEC_VPX_SLF_READ2_ADDR A:0x1d35730
y.create.l HWIO_VENUS0_VENUS_VPP_SE_DEC_VPX_SLF_READ3_ADDR A:0x1d35734
y.create.l HWIO_VENUS0_VENUS_VPP_SE_DEC_VPX_SLF_READ4_ADDR A:0x1d35738
y.create.l HWIO_VENUS0_VENUS_VPP_SE_DEC_VPX_SLF_READ5_ADDR A:0x1d3573c
y.create.l HWIO_VENUS0_VENUS_VPP_SE_DEC_VPX_SLF_READ6_ADDR A:0x1d35740
y.create.l HWIO_VENUS0_VENUS_VPP_SE_DEC_VPX_SLF_READ7_ADDR A:0x1d35744
y.create.l HWIO_VENUS0_VENUS_VPP_SE_DEC_SPARE_0_ADDR A:0x1d35748
y.create.l HWIO_VENUS0_VENUS_VPP_SE_DEC_SPARE_1_ADDR A:0x1d3574c
y.create.l HWIO_VENUS0_VENUS_VPP_PE_DEC_PIC_SIZE_ADDR A:0x1d36000
y.create.l HWIO_VENUS0_VENUS_VPP_PE_DEC_PIC_CFG_ADDR A:0x1d36004
y.create.l HWIO_VENUS0_VENUS_VPP_PE_DEC_REF_BYTES_PER_LINE_ADDR A:0x1d36008
y.create.l HWIO_VENUS0_VENUS_VPP_PE_DEC_FRAME_CONTROL_ADDR A:0x1d3600c
y.create.l HWIO_VENUS0_VENUS_VPP_PE_DEC_VC1_IC_RD_CTRL_ADDR A:0x1d36010
y.create.l HWIO_VENUS0_VENUS_VPP_PE_DEC_VC1_IC_CUR_TOP_ADDR A:0x1d36014
y.create.l HWIO_VENUS0_VENUS_VPP_PE_DEC_VC1_IC_CUR_BOT_ADDR A:0x1d36018
y.create.l HWIO_VENUS0_VENUS_VPP_PE_DEC_VC1_IC_FR_TOP_ADDR A:0x1d3601c
y.create.l HWIO_VENUS0_VENUS_VPP_PE_DEC_VC1_IC_FR_BOT_ADDR A:0x1d36020
y.create.l HWIO_VENUS0_VENUS_VPP_PE_DEC_VC1_IC_BR_ADDR A:0x1d36024
y.create.l HWIO_VENUS0_VENUS_VPP_PE_DEC_VP9_SCALE_FACTOR_ADDR A:0x1d36028
y.create.l HWIO_VENUS0_VENUS_VPP_PE_DEC_IRQ_MASK_ADDR A:0x1d3602c
y.create.l HWIO_VENUS0_VENUS_VPP_PE_DEC_IRQ_STATUS_ADDR A:0x1d36030
y.create.l HWIO_VENUS0_VENUS_VPP_PE_DEC_IRQ_CLEAR_ADDR A:0x1d36034
y.create.l HWIO_VENUS0_VENUS_VPP_PE_DEC_ERR_CFG1_ADDR A:0x1d36038
y.create.l HWIO_VENUS0_VENUS_VPP_PE_DEC_DEBUG_CFG_ADDR A:0x1d3603c
y.create.l HWIO_VENUS0_VENUS_VPP_PE_DEC_MISR_RESET_ADDR A:0x1d36040
y.create.l HWIO_VENUS0_VENUS_VPP_PE_DEC_MISR_ENABLE_ADDR A:0x1d36044
y.create.l HWIO_VENUS0_VENUS_VPP_PE_DEC_MISR_PE2FE_VAL_0_ADDR A:0x1d36048
y.create.l HWIO_VENUS0_VENUS_VPP_PE_DEC_TEST_BUS_CONTROL_ADDR A:0x1d3604c
y.create.l HWIO_VENUS0_VENUS_VPP_PE_DEC_TEST_BUS_REGISTER_ADDR A:0x1d36050
y.create.l HWIO_VENUS0_VENUS_VPP_PE_DEC_MISR_PE2FE_VAL_1_ADDR A:0x1d36054
y.create.l HWIO_VENUS0_VENUS_VPP_PE_DEC_MISR_PE2FE_VAL_2_ADDR A:0x1d36058
y.create.l HWIO_VENUS0_VENUS_VPP_PE_DEC_MISR_PE2FE_VAL_3_ADDR A:0x1d3605c
y.create.l HWIO_VENUS0_VENUS_VPP_PE_DEC_MISR_SE2TPRED_VAL_0_ADDR A:0x1d36060
y.create.l HWIO_VENUS0_VENUS_VPP_PE_DEC_MISR_SE2TPRED_VAL_1_ADDR A:0x1d36064
y.create.l HWIO_VENUS0_VENUS_VPP_PE_DEC_MISR_SE2SPRED_VAL_0_ADDR A:0x1d36068
y.create.l HWIO_VENUS0_VENUS_VPP_PE_DEC_MISR_SE2SPRED_VAL_1_ADDR A:0x1d3606c
y.create.l HWIO_VENUS0_VENUS_VPP_PE_DEC_SPARE_0_ADDR A:0x1d36070
y.create.l HWIO_VENUS0_VENUS_VPP_TE_DEC_PIC_CFG_ADDR A:0x1d37000
y.create.l HWIO_VENUS0_VENUS_VPP_TE_DEC_STATUS_ADDR A:0x1d37008
y.create.l HWIO_VENUS0_VENUS_VPP_TE_DEC_SPARE_ADDR A:0x1d3700c
y.create.l HWIO_VENUS0_VENUS_VPP_TE_DEC_SW_RESET_ADDR A:0x1d37010
y.create.l HWIO_VENUS0_VENUS_VPP_TE_DEC_IRQ_MASK_ADDR A:0x1d37014
y.create.l HWIO_VENUS0_VENUS_VPP_TE_DEC_IRQ_STATUS_ADDR A:0x1d37018
y.create.l HWIO_VENUS0_VENUS_VPP_TE_DEC_IRQ_CLEAR_ADDR A:0x1d3701c
y.create.l HWIO_VENUS0_VENUS_VPP_TE_DEC_MISR_RESET_ADDR A:0x1d37020
y.create.l HWIO_VENUS0_VENUS_VPP_TE_DEC_MISR_ENABLE_ADDR A:0x1d37024
y.create.l HWIO_VENUS0_VENUS_VPP_TE_DEC_MISR_TE2PE_VAL_0_ADDR A:0x1d37028
y.create.l HWIO_VENUS0_VENUS_VPP_TE_DEC_MISR_TE2PE_VAL_1_ADDR A:0x1d3702c
y.create.l HWIO_VENUS0_VENUS_VPP_TE_DEC_TEST_BUS_CONTROL_ADDR A:0x1d37030
y.create.l HWIO_VENUS0_VENUS_VPP_TE_DEC_TEST_BUS_REGISTER_ADDR A:0x1d37034
y.create.l HWIO_VENUS0_VENUS_VPP_TE_DEC_MISR_TE2PE_VAL_2_ADDR A:0x1d37038
y.create.l HWIO_VENUS0_VENUS_VPP_TE_DEC_MISR_SE2TE_VAL_0_ADDR A:0x1d3703c
y.create.l HWIO_VENUS0_VENUS_VPP_TE_DEC_MISR_SE2TE_VAL_1_ADDR A:0x1d37040
y.create.l HWIO_VENUS0_VENUS_VPP_TE_DEC_MISR_SE2TE_VAL_2_ADDR A:0x1d37044
y.create.l HWIO_VENUS0_VENUS_VPP_TE_DEC_SPARE_1_ADDR A:0x1d37048
y.create.l HWIO_VENUS0_VENUS_VPP_FE_DEC_PIC_CFG_ADDR A:0x1d38000
y.create.l HWIO_VENUS0_VENUS_VPP_FE_DEC_PIC_SIZE_ADDR A:0x1d38004
y.create.l HWIO_VENUS0_VENUS_VPP_FE_DEC_REF_BYTES_PER_LINE_ADDR A:0x1d38008
y.create.l HWIO_VENUS0_VENUS_VPP_FE_DEC_CODEC_CONFIG_ADDR A:0x1d3800c
y.create.l HWIO_VENUS0_VENUS_VPP_FE_DEC_STATUS_ADDR A:0x1d38010
y.create.l HWIO_VENUS0_VENUS_VPP_FE_DEC_IRQ_MASK_ADDR A:0x1d38014
y.create.l HWIO_VENUS0_VENUS_VPP_FE_DEC_IRQ_STATUS_ADDR A:0x1d38018
y.create.l HWIO_VENUS0_VENUS_VPP_FE_DEC_IRQ_CLEAR_ADDR A:0x1d3801c
y.create.l HWIO_VENUS0_VENUS_VPP_FE_DEC_TEST_BUS_CONTROL_ADDR A:0x1d38020
y.create.l HWIO_VENUS0_VENUS_VPP_FE_DEC_TEST_BUS_REGISTER_ADDR A:0x1d38024
y.create.l HWIO_VENUS0_VENUS_VPP_FE_DEC_MISR_RESET_ADDR A:0x1d38028
y.create.l HWIO_VENUS0_VENUS_VPP_FE_DEC_MISR_ENABLE_ADDR A:0x1d3802c
y.create.l HWIO_VENUS0_VENUS_VPP_FE_DEC_MISR_SE2FE_VAL_0_ADDR A:0x1d38030
y.create.l HWIO_VENUS0_VENUS_VPP_FE_DEC_MISR_SE2FE_VAL_1_ADDR A:0x1d38034
y.create.l HWIO_VENUS0_VENUS_VPP_FE_DEC_MISR_SE2FE_VAL_2_ADDR A:0x1d38038
y.create.l HWIO_VENUS0_VENUS_VPP_FE_DEC_MISR_SE2FE_VAL_3_ADDR A:0x1d3803c
y.create.l HWIO_VENUS0_VENUS_VPP_FE_DEC_MISR_SE2FE_VAL_4_ADDR A:0x1d38040
y.create.l HWIO_VENUS0_VENUS_VPP_FE_DEC_SPARE_0_ADDR A:0x1d38044
y.create.l HWIO_VENUS0_VENUS_DMA_DEC_CONFIG_ADDR A:0x1d3f000
y.create.l HWIO_VENUS0_VENUS_DMA_DEC_OPB_CFG_ADDR A:0x1d3f004
y.create.l HWIO_VENUS0_VENUS_DMA_DEC_DPB_CFG_ADDR A:0x1d3f008
y.create.l HWIO_VENUS0_VENUS_DMA_DEC_L1_CFG_ADDR A:0x1d3f00c
y.create.l HWIO_VENUS0_VENUS_DMA_DEC_L1C_STAT0_ADDR A:0x1d3f010
y.create.l HWIO_VENUS0_VENUS_DMA_DEC_L1C_STAT1_ADDR A:0x1d3f014
y.create.l HWIO_VENUS0_VENUS_DMA_DEC_L1C_STAT2_ADDR A:0x1d3f018
y.create.l HWIO_VENUS0_VENUS_DMA_DEC_L1C_STAT3_ADDR A:0x1d3f01c
y.create.l HWIO_VENUS0_VENUS_DMA_DEC_L1C_STAT4_ADDR A:0x1d3f020
y.create.l HWIO_VENUS0_VENUS_DMA_DEC_L1C_STAT5_ADDR A:0x1d3f024
y.create.l HWIO_VENUS0_VENUS_DMA_DEC_L1C_STAT6_ADDR A:0x1d3f028
y.create.l HWIO_VENUS0_VENUS_DMA_DEC_L1C_STAT7_ADDR A:0x1d3f02c
y.create.l HWIO_VENUS0_VENUS_DMA_DEC_L1C_STAT8_ADDR A:0x1d3f030
y.create.l HWIO_VENUS0_VENUS_DMA_DEC_L1C_STAT9_ADDR A:0x1d3f034
y.create.l HWIO_VENUS0_VENUS_DMA_DEC_CACHE_RESET_ADDR A:0x1d3f050
y.create.l HWIO_VENUS0_VENUS_DMA_DEC_UBWC_STATUS_ADDR A:0x1d3f054
y.create.l HWIO_VENUS0_VENUS_DMA_DEC_LB_DEST_ADDR A:0x1d3f100
y.create.l HWIO_VENUS0_VENUS_DMA_DEC_WB_REF_FRAME_SIZE_ADDR A:0x1d3f104
y.create.l HWIO_VENUS0_VENUS_DMA_DEC_WB_REC_FRAME_SIZE_ADDR A:0x1d3f108
y.create.l HWIO_VENUS0_VENUS_DMA_DEC_REF_BYTES_PER_LINE_ADDR A:0x1d3f10c
y.create.l HWIO_VENUS0_VENUS_DMA_DEC_DS_BYTES_PER_LINE_ADDR A:0x1d3f110
y.create.l HWIO_VENUS0_VENUS_DMA_DEC_VSP_LB_DEST_ADDR A:0x1d3f114
y.create.l HWIO_VENUS0_VENUS_DMA_DEC_DS_FRAME_SIZE_ADDR A:0x1d3f118
y.create.l HWIO_VENUS0_VENUS_DMA_DEC_BUFF_START_ADDR0_ADDR A:0x1d3f200
y.create.l HWIO_VENUS0_VENUS_DMA_DEC_BUFF_START_ADDR1_ADDR A:0x1d3f204
y.create.l HWIO_VENUS0_VENUS_DMA_DEC_BUFF_START_ADDR2_ADDR A:0x1d3f208
y.create.l HWIO_VENUS0_VENUS_DMA_DEC_BUFF_START_ADDR3_ADDR A:0x1d3f20c
y.create.l HWIO_VENUS0_VENUS_DMA_DEC_BUFF_START_ADDR4_ADDR A:0x1d3f210
y.create.l HWIO_VENUS0_VENUS_DMA_DEC_BUFF_START_ADDR5_ADDR A:0x1d3f214
y.create.l HWIO_VENUS0_VENUS_DMA_DEC_BUFF_START_ADDR6_ADDR A:0x1d3f218
y.create.l HWIO_VENUS0_VENUS_DMA_DEC_BUFF_START_ADDR7_ADDR A:0x1d3f21c
y.create.l HWIO_VENUS0_VENUS_DMA_DEC_BUFF_START_ADDR8_ADDR A:0x1d3f220
y.create.l HWIO_VENUS0_VENUS_DMA_DEC_BUFF_START_ADDR9_ADDR A:0x1d3f224
y.create.l HWIO_VENUS0_VENUS_DMA_DEC_BUFF_SSID0_ADDR A:0x1d3f400
y.create.l HWIO_VENUS0_VENUS_DMA_DEC_BUFF_SSID1_ADDR A:0x1d3f404
y.create.l HWIO_VENUS0_VENUS_DMA_DEC_BUFF_SSID2_ADDR A:0x1d3f408
y.create.l HWIO_VENUS0_VENUS_DMA_DEC_BUFF_SSID3_ADDR A:0x1d3f40c
y.create.l HWIO_VENUS0_VENUS_DMA_DEC_BUFF_SSID4_ADDR A:0x1d3f410
y.create.l HWIO_VENUS0_VENUS_DMA_DEC_BUFF_SSID5_ADDR A:0x1d3f414
y.create.l HWIO_VENUS0_VENUS_DMA_DEC_BUFF_SSID6_ADDR A:0x1d3f418
y.create.l HWIO_VENUS0_VENUS_DMA_DEC_BUFF_SSID7_ADDR A:0x1d3f41c
y.create.l HWIO_VENUS0_VENUS_DMA_DEC_BUFF_SSID8_ADDR A:0x1d3f420
y.create.l HWIO_VENUS0_VENUS_DMA_DEC_BUFF_SSID9_ADDR A:0x1d3f424
y.create.l HWIO_VENUS0_VENUS_DMA_DEC_L2_CFG_ADDR A:0x1d3f500
y.create.l HWIO_VENUS0_VENUS_DMA_DEC_L2_START_ADDR_ADDR A:0x1d3f504
y.create.l HWIO_VENUS0_VENUS_DMA_DEC_L2C_STAT0_ADDR A:0x1d3f510
y.create.l HWIO_VENUS0_VENUS_DMA_DEC_L2C_STAT1_ADDR A:0x1d3f514
y.create.l HWIO_VENUS0_VENUS_DMA_DEC_L2C_STAT2_ADDR A:0x1d3f518
y.create.l HWIO_VENUS0_VENUS_DMA_DEC_L2C_STAT3_ADDR A:0x1d3f51c
y.create.l HWIO_VENUS0_VENUS_DMA_DEC_L2C_STAT4_ADDR A:0x1d3f520
y.create.l HWIO_VENUS0_VENUS_DMA_DEC_L2C_STAT5_ADDR A:0x1d3f524
y.create.l HWIO_VENUS0_VENUS_DMA_DEC_L2C_STAT6_ADDR A:0x1d3f528
y.create.l HWIO_VENUS0_VENUS_DMA_DEC_L2C_STAT7_ADDR A:0x1d3f52c
y.create.l HWIO_VENUS0_VENUS_DMA_DEC_L2C_STAT8_ADDR A:0x1d3f530
y.create.l HWIO_VENUS0_VENUS_DMA_DEC_L2C_STAT9_ADDR A:0x1d3f534
y.create.l HWIO_VENUS0_VENUS_DMA_DEC_DYN_SEL_CTRL_ADDR A:0x1d3f600
y.create.l HWIO_VENUS0_VENUS_DMA_DEC_MV_BIN_CNT0_ADDR A:0x1d3f604
y.create.l HWIO_VENUS0_VENUS_DMA_DEC_MV_BIN_CNT1_ADDR A:0x1d3f608
y.create.l HWIO_VENUS0_VENUS_DMA_DEC_MV_BIN_CNT2_ADDR A:0x1d3f60c
y.create.l HWIO_VENUS0_VENUS_DMA_DEC_MV_BIN_CNT3_ADDR A:0x1d3f610
y.create.l HWIO_VENUS0_VENUS_DMA_DEC_MV_BIN_CNT4_ADDR A:0x1d3f614
y.create.l HWIO_VENUS0_VENUS_DMA_DEC_MV_BIN_CNT5_ADDR A:0x1d3f618
y.create.l HWIO_VENUS0_VENUS_DMA_DEC_MV_BIN_CNT6_ADDR A:0x1d3f61c
y.create.l HWIO_VENUS0_VENUS_DMA_DEC_MV_BIN_CNT7_ADDR A:0x1d3f620
y.create.l HWIO_VENUS0_VENUS_DMA_DEC_MV_BIN_CNT8_ADDR A:0x1d3f624
y.create.l HWIO_VENUS0_VENUS_DMA_DEC_MV_BIN_CNT9_ADDR A:0x1d3f628
y.create.l HWIO_VENUS0_VENUS_DMA_DEC_LCU_CNT_ADDR A:0x1d3f684
y.create.l HWIO_VENUS0_VENUS_DMA_DOM_IDX_ADDR A:0x1d3f688
y.create.l HWIO_VENUS0_VENUS_DMA_DEC_L1_DOM_IDX_ADDR A:0x1d3f68c
y.create.l HWIO_VENUS0_VENUS_DMA_DEC_MISR_RESET_ADDR A:0x1d3f700
y.create.l HWIO_VENUS0_VENUS_DMA_DEC_MISR_ENABLE_ADDR A:0x1d3f704
y.create.l HWIO_VENUS0_VENUS_DMA_DEC_MISR_FE2DMA_RECON_VAL_0_ADDR A:0x1d3f708
y.create.l HWIO_VENUS0_VENUS_DMA_DEC_MISR_FE2DMA_RECON_VAL_1_ADDR A:0x1d3f70c
y.create.l HWIO_VENUS0_VENUS_DMA_DEC_MISR_FE2DMA_RECON_VAL_2_ADDR A:0x1d3f710
y.create.l HWIO_VENUS0_VENUS_DMA_DEC_MISR_PPE2DMA_RECON_VAL_0_ADDR A:0x1d3f714
y.create.l HWIO_VENUS0_VENUS_DMA_DEC_MISR_PPE2DMA_RECON_VAL_1_ADDR A:0x1d3f718
y.create.l HWIO_VENUS0_VENUS_DMA_DEC_MISR_PPE2DMA_RECON_VAL_2_ADDR A:0x1d3f71c
y.create.l HWIO_VENUS0_VENUS_DMA_DEC_MISR_CCE2DMA_VAL_0_ADDR A:0x1d3f720
y.create.l HWIO_VENUS0_VENUS_DMA_DEC_MISR_CCE2DMA_VAL_1_ADDR A:0x1d3f724
y.create.l HWIO_VENUS0_VENUS_DMA_DEC_MISR_CCE2DMA_VAL_2_ADDR A:0x1d3f728
y.create.l HWIO_VENUS0_VENUS_DMA_DEC_MISR_CCE2DMA_VAL_3_ADDR A:0x1d3f72c
y.create.l HWIO_VENUS0_VENUS_DMA_DEC_MISR_CCE2DMA_VAL_4_ADDR A:0x1d3f730
y.create.l HWIO_VENUS0_VENUS_DMA_DEC_MISR_FE2DMA_LBUF_VAL_0_ADDR A:0x1d3f734
y.create.l HWIO_VENUS0_VENUS_DMA_DEC_L1C_STAT_LOAD_ADDR A:0x1d3f738
y.create.l HWIO_VENUS0_VENUS_DMA_DEC_L2C_STAT_LOAD_ADDR A:0x1d3f73c
y.create.l HWIO_VENUS0_VENUS_DMA_DEC_MV_BIN_CNT_LOAD_ADDR A:0x1d3f740
y.create.l HWIO_VENUS0_VENUS_DMA_DEC_LCU_CNT_LOAD_ADDR A:0x1d3f744
y.create.l HWIO_VENUS0_VENUS_DMA_DEC_DOM_IDX_LOAD_ADDR A:0x1d3f748
y.create.l HWIO_VENUS0_VENUS_DMA_DEC_TEST_BUS_CONTROL_ADDR A:0x1d3f74c
y.create.l HWIO_VENUS0_VENUS_DMA_DEC_TEST_BUS_REGISTER_ADDR A:0x1d3f750
y.create.l HWIO_VENUS0_VENUS_DMA_DEC_STATUS_REGISTER_ADDR A:0x1d3f754
y.create.l HWIO_VENUS0_VENUS_DMA_DEC_META_DATA_REF_LUMA_START_INIT_ADDR A:0x1d3f800
y.create.l HWIO_VENUS0_VENUS_DMA_DEC_META_DATA_REF_LUMA_START_ADDR_ADDR A:0x1d3f804
y.create.l HWIO_VENUS0_VENUS_DMA_DEC_META_DATA_REF_CHROMA_START_INIT_ADDR A:0x1d3f808
y.create.l HWIO_VENUS0_VENUS_DMA_DEC_META_DATA_REF_CHROMA_START_ADDR_ADDR A:0x1d3f80c
y.create.l HWIO_VENUS0_VENUS_DMA_DEC_SDE_BIT_BUF_START_INIT_ADDR A:0x1d3f810
y.create.l HWIO_VENUS0_VENUS_DMA_DEC_SDE_BIT_BUF_START_ADDR_ADDR A:0x1d3f814
y.create.l HWIO_VENUS0_VENUS_DMA_DEC_SDE_BIN_BUF_START_INIT_ADDR A:0x1d3f818
y.create.l HWIO_VENUS0_VENUS_DMA_DEC_SDE_BIN_BUF_START_ADDR_ADDR A:0x1d3f81c
y.create.l HWIO_VENUS0_VENUS_DMA_DEC_SE_BIN_BUF_START_INIT_ADDR A:0x1d3f820
y.create.l HWIO_VENUS0_VENUS_DMA_DEC_SE_BIN_BUF_START_ADDR_ADDR A:0x1d3f824
y.create.l HWIO_VENUS0_VENUS_DMA_DEC_REF_FRAME_ADDR_LUMA_START_INIT_ADDR A:0x1d3f828
y.create.l HWIO_VENUS0_VENUS_DMA_DEC_REF_FRAME_LUMA_START_ADDR_ADDR A:0x1d3f82c
y.create.l HWIO_VENUS0_VENUS_DMA_DEC_REF_FRAME_CHROMA_ADDR_START_INIT_ADDR A:0x1d3f830
y.create.l HWIO_VENUS0_VENUS_DMA_DEC_REF_FRAME_CHROMA_START_ADDR_ADDR A:0x1d3f834
y.create.l HWIO_VENUS0_VENUS_DMA_DEC_MISR_FE2DMA_LBUF_VAL_1_ADDR A:0x1d3f838
y.create.l HWIO_VENUS0_VENUS_DMA_DEC_MISR_FE2DMA_LBUF_VAL_2_ADDR A:0x1d3f83c
y.create.l HWIO_VENUS0_VENUS_DMA_DEC_MISR_FE2DMA_LBUF_VAL_3_ADDR A:0x1d3f840
y.create.l HWIO_VENUS0_VENUS_DMA_DEC_MISR_FE2DMA_LBUF_VAL_4_ADDR A:0x1d3f844
y.create.l HWIO_VENUS0_VENUS_DMA_DEC_MISR_SDE2DMA_VAL_0_ADDR A:0x1d3f848
y.create.l HWIO_VENUS0_VENUS_DMA_DEC_MISR_SDE2DMA_VAL_1_ADDR A:0x1d3f84c
y.create.l HWIO_VENUS0_VENUS_DMA_DEC_MISR_SDE2DMA_VAL_2_ADDR A:0x1d3f850
y.create.l HWIO_VENUS0_VENUS_DMA_DEC_MISR_SDE2DMA_VAL_3_ADDR A:0x1d3f854
y.create.l HWIO_VENUS0_VENUS_DMA_DEC_MISR_SDE2DMA_VAL_4_ADDR A:0x1d3f858
y.create.l HWIO_VENUS0_VENUS_DMA_DEC_MISR_PPE2DMA_LBUF_VAL_0_ADDR A:0x1d3f85c
y.create.l HWIO_VENUS0_VENUS_DMA_DEC_MISR_PPE2DMA_LBUF_VAL_1_ADDR A:0x1d3f860
y.create.l HWIO_VENUS0_VENUS_DMA_DEC_MISR_PPE2DMA_LBUF_VAL_2_ADDR A:0x1d3f864
y.create.l HWIO_VENUS0_VENUS_DMA_DEC_MISR_PPE2DMA_LBUF_VAL_3_ADDR A:0x1d3f868
y.create.l HWIO_VENUS0_VENUS_DMA_DEC_MISR_PPE2DMA_LBUF_VAL_4_ADDR A:0x1d3f86c
y.create.l HWIO_VENUS0_VENUS_DMA_DEC_REC_BYTES_PER_LINE_ADDR A:0x1d3f870
y.create.l HWIO_VENUS0_VENUS_DMA_DEC_REF1_BYTES_PER_LINE_ADDR A:0x1d3f874
y.create.l HWIO_VENUS0_VENUS_DMA_DEC_REF2_BYTES_PER_LINE_ADDR A:0x1d3f878
y.create.l HWIO_VENUS0_VENUS_DMA_DEC_SPARE_3_ADDR A:0x1d3f87c
y.create.l HWIO_VENUS0_VENUS_DMA_DEC_SPARE_4_ADDR A:0x1d3f880
y.create.l HWIO_VENUS0_VENUS_DMA_DEC_SPARE_5_ADDR A:0x1d3f884
y.create.l HWIO_VENUS0_VENUS_DMA_DEC_SPARE_6_ADDR A:0x1d3f888
y.create.l HWIO_VENUS0_VENUS_DMA_DEC_SPARE_7_ADDR A:0x1d3f88c
y.create.l HWIO_VENUS0_VENUS_CPU_WD_WDOGLOAD_ADDR A:0x1dc1000
y.create.l HWIO_VENUS0_VENUS_CPU_WD_WDOGVALUE_ADDR A:0x1dc1004
y.create.l HWIO_VENUS0_VENUS_CPU_WD_WDOGCONTROL_ADDR A:0x1dc1008
y.create.l HWIO_VENUS0_VENUS_CPU_WD_WDOGINTCLR_ADDR A:0x1dc100c
y.create.l HWIO_VENUS0_VENUS_CPU_WD_WDOGRIS_ADDR A:0x1dc1010
y.create.l HWIO_VENUS0_VENUS_CPU_WD_WDOGMIS_ADDR A:0x1dc1014
y.create.l HWIO_VENUS0_VENUS_CPU_WD_WDOGLOCK_ADDR A:0x1dc1c00
y.create.l HWIO_VENUS0_VENUS_CPU_WD_WDOGITCR_ADDR A:0x1dc1f00
y.create.l HWIO_VENUS0_VENUS_CPU_WD_WDOGITOP_ADDR A:0x1dc1f04
y.create.l HWIO_VENUS0_VENUS_CPU_WD_WDOGPERIPHID0_ADDR A:0x1dc1fe0
y.create.l HWIO_VENUS0_VENUS_CPU_WD_WDOGPERIPHID1_ADDR A:0x1dc1fe4
y.create.l HWIO_VENUS0_VENUS_CPU_WD_WDOGPERIPHID2_ADDR A:0x1dc1fe8
y.create.l HWIO_VENUS0_VENUS_CPU_WD_WDOGPERIPHID3_ADDR A:0x1dc1fec
y.create.l HWIO_VENUS0_VENUS_CPU_WD_WWDOGPCELLID0_ADDR A:0x1dc1ff0
y.create.l HWIO_VENUS0_VENUS_CPU_WD_WDOGPCELLID1_ADDR A:0x1dc1ff4
y.create.l HWIO_VENUS0_VENUS_CPU_WD_WDOGPCELLID2_ADDR A:0x1dc1ff8
y.create.l HWIO_VENUS0_VENUS_CPU_WD_WDOGPCELLID3_ADDR A:0x1dc1ffc
y.create.l HWIO_VENUS0_VENUS_CPU_TM_TIMER1LOAD_ADDR A:0x1dc2000
y.create.l HWIO_VENUS0_VENUS_CPU_TM_TIMER1VALUE_ADDR A:0x1dc2004
y.create.l HWIO_VENUS0_VENUS_CPU_TM_TIMER1CONTROL_ADDR A:0x1dc2008
y.create.l HWIO_VENUS0_VENUS_CPU_TM_TIMER1INTCLR_ADDR A:0x1dc200c
y.create.l HWIO_VENUS0_VENUS_CPU_TM_TIMER1RIS_ADDR A:0x1dc2010
y.create.l HWIO_VENUS0_VENUS_CPU_TM_TIMER1MIS_ADDR A:0x1dc2014
y.create.l HWIO_VENUS0_VENUS_CPU_TM_TIMER1BGLOAD_ADDR A:0x1dc2018
y.create.l HWIO_VENUS0_VENUS_CPU_TM_TIMER2LOAD_ADDR A:0x1dc2020
y.create.l HWIO_VENUS0_VENUS_CPU_TM_TIMER2VALUE_ADDR A:0x1dc2024
y.create.l HWIO_VENUS0_VENUS_CPU_TM_TIMER2CONTROL_ADDR A:0x1dc2028
y.create.l HWIO_VENUS0_VENUS_CPU_TM_TIMER2INTCLR_ADDR A:0x1dc202c
y.create.l HWIO_VENUS0_VENUS_CPU_TM_TIMER2RIS_ADDR A:0x1dc2030
y.create.l HWIO_VENUS0_VENUS_CPU_TM_TIMER2MIS_ADDR A:0x1dc2034
y.create.l HWIO_VENUS0_VENUS_CPU_TM_TIMER2BGLOAD_ADDR A:0x1dc2038
y.create.l HWIO_VENUS0_VENUS_CPU_TM_TIMERITCR_ADDR A:0x1dc2f00
y.create.l HWIO_VENUS0_VENUS_CPU_TM_TIMERITOP_ADDR A:0x1dc2f04
y.create.l HWIO_VENUS0_VENUS_CPU_TM_TIMERPERIPHID0_ADDR A:0x1dc2fe0
y.create.l HWIO_VENUS0_VENUS_CPU_TM_TIMERPERIPHID1_ADDR A:0x1dc2fe4
y.create.l HWIO_VENUS0_VENUS_CPU_TM_TIMERPERIPHID2_ADDR A:0x1dc2fe8
y.create.l HWIO_VENUS0_VENUS_CPU_TM_TIMERPERIPHID3_ADDR A:0x1dc2fec
y.create.l HWIO_VENUS0_VENUS_CPU_TM_TIMERPCELLID0_ADDR A:0x1dc2ff0
y.create.l HWIO_VENUS0_VENUS_CPU_TM_TIMERPCELLID1_ADDR A:0x1dc2ff4
y.create.l HWIO_VENUS0_VENUS_CPU_TM_TIMERPCELLID2_ADDR A:0x1dc2ff8
y.create.l HWIO_VENUS0_VENUS_CPU_TM_TIMERPCELLID3_ADDR A:0x1dc2ffc
y.create.l HWIO_VENUS0_VENUS_CPU_CS_REMAP_ADDR A:0x1dd2000
y.create.l HWIO_VENUS0_VENUS_CPU_CS_TIMERCONTROL_ADDR A:0x1dd2004
y.create.l HWIO_VENUS0_VENUS_CPU_CS_A2HSOFTINTEN_ADDR A:0x1dd2010
y.create.l HWIO_VENUS0_VENUS_CPU_CS_A2HSOFTINTENCLR_ADDR A:0x1dd2014
y.create.l HWIO_VENUS0_VENUS_CPU_CS_A2HSOFTINT_ADDR A:0x1dd2018
y.create.l HWIO_VENUS0_VENUS_CPU_CS_A2HSOFTINTCLR_ADDR A:0x1dd201c
y.create.l HWIO_VENUS0_VENUS_CPU_CS_VCICMD_ADDR A:0x1dd2020
y.create.l HWIO_VENUS0_VENUS_CPU_CS_VCICMDARG0_ADDR A:0x1dd2024
y.create.l HWIO_VENUS0_VENUS_CPU_CS_VCICMDARG1_ADDR A:0x1dd2028
y.create.l HWIO_VENUS0_VENUS_CPU_CS_VCICMDARG2_ADDR A:0x1dd202c
y.create.l HWIO_VENUS0_VENUS_CPU_CS_VCICMDARG3_ADDR A:0x1dd2030
y.create.l HWIO_VENUS0_VENUS_CPU_CS_VMIMSG_ADDR A:0x1dd2034
y.create.l HWIO_VENUS0_VENUS_CPU_CS_VMIMSGAG0_ADDR A:0x1dd2038
y.create.l HWIO_VENUS0_VENUS_CPU_CS_VMIMSGAG1_ADDR A:0x1dd203c
y.create.l HWIO_VENUS0_VENUS_CPU_CS_VMIMSGAG2_ADDR A:0x1dd2040
y.create.l HWIO_VENUS0_VENUS_CPU_CS_VMIMSGAG3_ADDR A:0x1dd2044
y.create.l HWIO_VENUS0_VENUS_CPU_CS_SCIACMD_ADDR A:0x1dd2048
y.create.l HWIO_VENUS0_VENUS_CPU_CS_SCIACMDARG0_ADDR A:0x1dd204c
y.create.l HWIO_VENUS0_VENUS_CPU_CS_SCIACMDARG1_ADDR A:0x1dd2050
y.create.l HWIO_VENUS0_VENUS_CPU_CS_SCIACMDARG2_ADDR A:0x1dd2054
y.create.l HWIO_VENUS0_VENUS_CPU_CS_SCIACMDARG3_ADDR A:0x1dd2058
y.create.l HWIO_VENUS0_VENUS_CPU_CS_SCIBCMD_ADDR A:0x1dd205c
y.create.l HWIO_VENUS0_VENUS_CPU_CS_SCIBCMDARG0_ADDR A:0x1dd2060
y.create.l HWIO_VENUS0_VENUS_CPU_CS_SCIBARG1_ADDR A:0x1dd2064
y.create.l HWIO_VENUS0_VENUS_CPU_CS_SCIBARG2_ADDR A:0x1dd2068
y.create.l HWIO_VENUS0_VENUS_CPU_CS_SCIBARG3_ADDR A:0x1dd206c
y.create.l HWIO_VENUS0_VENUS_CPU_CS_DEBUGSEL_ADDR A:0x1dd2070
y.create.l HWIO_VENUS0_VENUS_CPU_CS_MASTER0_CONFIG_ADDR A:0x1dd2074
y.create.l HWIO_VENUS0_VENUS_CPU_CS_MASTER0_MASK_ADDR A:0x1dd2078
y.create.l HWIO_VENUS0_VENUS_CPU_CS_MASTER0_MATCH_ADDR A:0x1dd207c
y.create.l HWIO_VENUS0_VENUS_CPU_CS_MASTER0_COUNT_ADDR A:0x1dd2080
y.create.l HWIO_VENUS0_VENUS_CPU_CS_MASTER0_LAT_COUNT_ADDR A:0x1dd2084
y.create.l HWIO_VENUS0_VENUS_CPU_CS_MASTER0_LAT_MAX_COUNT_ADDR A:0x1dd2088
y.create.l HWIO_VENUS0_VENUS_CPU_CS_SLAVE0_CONFIG_ADDR A:0x1dd208c
y.create.l HWIO_VENUS0_VENUS_CPU_CS_SLAVE0_MASK_ADDR A:0x1dd2090
y.create.l HWIO_VENUS0_VENUS_CPU_CS_SLAVE0_MATCH_ADDR A:0x1dd2094
y.create.l HWIO_VENUS0_VENUS_CPU_CS_SLAVE0_COUNT_ADDR A:0x1dd2098
y.create.l HWIO_VENUS0_VENUS_CPU_CS_SLAVE0_LAT_COUNT_ADDR A:0x1dd209c
y.create.l HWIO_VENUS0_VENUS_CPU_CS_SLAVE0_LAT_MAX_COUNT_ADDR A:0x1dd20a0
y.create.l HWIO_VENUS0_VENUS_CPU_CS_MASTER1_CONFIG_ADDR A:0x1dd20a4
y.create.l HWIO_VENUS0_VENUS_CPU_CS_MASTER1_MASK_ADDR A:0x1dd20a8
y.create.l HWIO_VENUS0_VENUS_CPU_CS_MASTER1_MATCH_ADDR A:0x1dd20ac
y.create.l HWIO_VENUS0_VENUS_CPU_CS_MASTER1_COUNT_ADDR A:0x1dd20b0
y.create.l HWIO_VENUS0_VENUS_CPU_CS_MASTER1_LAT_COUNT_ADDR A:0x1dd20b4
y.create.l HWIO_VENUS0_VENUS_CPU_CS_MASTER1_LAT_MAX_COUNT_ADDR A:0x1dd20b8
y.create.l HWIO_VENUS0_VENUS_CPU_CS_SLAVE1_CONFIG_ADDR A:0x1dd20bc
y.create.l HWIO_VENUS0_VENUS_CPU_CS_SLAVE1_MASK_ADDR A:0x1dd20c0
y.create.l HWIO_VENUS0_VENUS_CPU_CS_SLAVE1_MATCH_ADDR A:0x1dd20c4
y.create.l HWIO_VENUS0_VENUS_CPU_CS_SLAVE1_COUNT_ADDR A:0x1dd20c8
y.create.l HWIO_VENUS0_VENUS_CPU_CS_SLAVE1_LAT_COUNT_ADDR A:0x1dd20cc
y.create.l HWIO_VENUS0_VENUS_CPU_CS_SLAVE1_LAT_MAX_COUNT_ADDR A:0x1dd20d0
y.create.l HWIO_VENUS0_VENUS_CPU_CS_AXI_CONFIG_ADDR A:0x1dd20d4
y.create.l HWIO_VENUS0_VENUS_CPU_CS_AXI_MASK_ADDR A:0x1dd20d8
y.create.l HWIO_VENUS0_VENUS_CPU_CS_AXI_ADDR_MATCH_ADDR A:0x1dd20dc
y.create.l HWIO_VENUS0_VENUS_CPU_CS_AXI_ADDR_CNTRL_MATCH_ADDR A:0x1dd20e0
y.create.l HWIO_VENUS0_VENUS_CPU_CS_AXI_ADDR_MATCH_COUNT_ADDR A:0x1dd20e4
y.create.l HWIO_VENUS0_VENUS_CPU_CS_AXI_WR_ERR_COUNT_ADDR A:0x1dd20e8
y.create.l HWIO_VENUS0_VENUS_CPU_CS_AXI_RD_ERR_COUNT_ADDR A:0x1dd20ec
y.create.l HWIO_VENUS0_VENUS_CPU_CS_AXI_WR_LAT_COUNT_ADDR A:0x1dd20f0
y.create.l HWIO_VENUS0_VENUS_CPU_CS_AXI_RD_LAT_COUNT_ADDR A:0x1dd20f4
y.create.l HWIO_VENUS0_VENUS_CPU_CS_AXI_WR_LAT_MAX_COUNT_ADDR A:0x1dd20f8
y.create.l HWIO_VENUS0_VENUS_CPU_CS_AXI_RD_LAT_MAX_COUNT_ADDR A:0x1dd20fc
y.create.l HWIO_VENUS0_VENUS_CPU_CS_AHBERRINTEN_ADDR A:0x1dd2100
y.create.l HWIO_VENUS0_VENUS_CPU_CS_AHBERRINTENCLR_ADDR A:0x1dd2104
y.create.l HWIO_VENUS0_VENUS_CPU_CS_VBIF_SSID_ADDR A:0x1dd2108
y.create.l HWIO_VENUS0_VENUS_CPU_CS_JTAGTCKEN_ADDR A:0x1dd210c
y.create.l HWIO_VENUS0_VENUS_CPU_CS_CGCEN_ADDR A:0x1dd2110
y.create.l HWIO_VENUS0_VENUS_CPU_IC_ICIRQSTATUS_ADDR A:0x1ddf000
y.create.l HWIO_VENUS0_VENUS_CPU_IC_ICFIQSTATUS_ADDR A:0x1ddf004
y.create.l HWIO_VENUS0_VENUS_CPU_IC_ICRAWINTR_ADDR A:0x1ddf008
y.create.l HWIO_VENUS0_VENUS_CPU_IC_ICINTSELECT_ADDR A:0x1ddf00c
y.create.l HWIO_VENUS0_VENUS_CPU_IC_ICINTENABLE_ADDR A:0x1ddf010
y.create.l HWIO_VENUS0_VENUS_CPU_IC_ICINTENCLEAR_ADDR A:0x1ddf014
y.create.l HWIO_VENUS0_VENUS_CPU_IC_ICSOFTINT_ADDR A:0x1ddf018
y.create.l HWIO_VENUS0_VENUS_CPU_IC_ICSOFTINTCLEAR_ADDR A:0x1ddf01c
y.create.l HWIO_VENUS0_VENUS_CPU_IC_ICPROTECTION_ADDR A:0x1ddf020
y.create.l HWIO_VENUS0_VENUS_CPU_IC_ICVECTADDR_ADDR A:0x1ddf030
y.create.l HWIO_VENUS0_VENUS_CPU_IC_ICDEFVECTADDR_ADDR A:0x1ddf034
y.create.l HWIO_VENUS0_VENUS_CPU_IC_ICITCR_ADDR A:0x1ddf300
y.create.l HWIO_VENUS0_VENUS_CPU_IC_ICITIP1_ADDR A:0x1ddf304
y.create.l HWIO_VENUS0_VENUS_CPU_IC_ICITIP2_ADDR A:0x1ddf308
y.create.l HWIO_VENUS0_VENUS_CPU_IC_ICITOP1_ADDR A:0x1ddf30c
y.create.l HWIO_VENUS0_VENUS_CPU_IC_ICITOP2_ADDR A:0x1ddf310
y.create.l HWIO_VENUS0_VENUS_CPU_IC_ICPERIPHID0_ADDR A:0x1ddffe0
y.create.l HWIO_VENUS0_VENUS_CPU_IC_ICPERIPHID1_ADDR A:0x1ddffe4
y.create.l HWIO_VENUS0_VENUS_CPU_IC_ICPERIPHID2_ADDR A:0x1ddffe8
y.create.l HWIO_VENUS0_VENUS_CPU_IC_ICPERIPHID3_ADDR A:0x1ddffec
y.create.l HWIO_VENUS0_VENUS_CPU_IC_ICPCELLID0_ADDR A:0x1ddfff0
y.create.l HWIO_VENUS0_VENUS_CPU_IC_ICPCELLID1_ADDR A:0x1ddfff4
y.create.l HWIO_VENUS0_VENUS_CPU_IC_ICPCELLID2_ADDR A:0x1ddfff8
y.create.l HWIO_VENUS0_VENUS_CPU_IC_ICPCELLID3_ADDR A:0x1ddfffc
y.create.l HWIO_VENUS0_VENUS_VBIF_VERSION_ADDR A:0x1d80000
y.create.l HWIO_VENUS0_VENUS_VBIF_CLKON_ADDR A:0x1d80004
y.create.l HWIO_VENUS0_VENUS_VBIF_CLK_FORCE_CTRL0_ADDR A:0x1d80008
y.create.l HWIO_VENUS0_VENUS_VBIF_CLK_FORCE_CTRL1_ADDR A:0x1d8000c
y.create.l HWIO_VENUS0_VENUS_VBIF_QOS_OVERRIDE_EN_ADDR A:0x1d80010
y.create.l HWIO_VENUS0_VENUS_VBIF_PRILVL_ACT_PROP_EN_ADDR A:0x1d80014
y.create.l HWIO_VENUS0_VENUS_VBIF_QOS_OVERRIDE_REQPRI_ADDR A:0x1d80018
y.create.l HWIO_VENUS0_VENUS_VBIF_QOS_OVERRIDE_PRILVL_ADDR A:0x1d8001c
y.create.l HWIO_VENUS0_VENUS_VBIF_QOS_REMAP_00_ADDR A:0x1d80020
y.create.l HWIO_VENUS0_VENUS_VBIF_QOS_REMAP_01_ADDR A:0x1d80024
y.create.l HWIO_VENUS0_VENUS_VBIF_QOS_REMAP_10_ADDR A:0x1d80028
y.create.l HWIO_VENUS0_VENUS_VBIF_QOS_REMAP_11_ADDR A:0x1d8002c
y.create.l HWIO_VENUS0_VENUS_VBIF_IN_RD_LIM_CONF0_ADDR A:0x1d800b0
y.create.l HWIO_VENUS0_VENUS_VBIF_IN_WR_LIM_CONF0_ADDR A:0x1d800c0
y.create.l HWIO_VENUS0_VENUS_VBIF_OUT_RD_LIM_CONF0_ADDR A:0x1d800d0
y.create.l HWIO_VENUS0_VENUS_VBIF_OUT_WR_LIM_CONF0_ADDR A:0x1d800d4
y.create.l HWIO_VENUS0_VENUS_VBIF_DDR_OUT_MAX_BURST_ADDR A:0x1d800d8
y.create.l HWIO_VENUS0_VENUS_VBIF_ISO_SYNC_ADDR A:0x1d800e0
y.create.l HWIO_VENUS0_VENUS_VBIF_ARB_CTL_ADDR A:0x1d800f0
y.create.l HWIO_VENUS0_VENUS_VBIF_DDR_ARB_CONF0_ADDR A:0x1d800f4
y.create.l HWIO_VENUS0_VENUS_VBIF_FIXED_ARB_CONF0_ADDR A:0x1d80100
y.create.l HWIO_VENUS0_VENUS_VBIF_ROUND_ROBIN_QOS_ARB_ADDR A:0x1d80124
y.create.l HWIO_VENUS0_VENUS_VBIF_OUT_AXI_AMEMTYPE_CONF0_ADDR A:0x1d80160
y.create.l HWIO_VENUS0_VENUS_VBIF_OUT_AXI_AINST_OVERRIDE_EN_ADDR A:0x1d80168
y.create.l HWIO_VENUS0_VENUS_VBIF_OUT_AXI_AINST_ADDR A:0x1d8016c
y.create.l HWIO_VENUS0_VENUS_VBIF_OUT_AXI_ASHARED_ADDR A:0x1d80170
y.create.l HWIO_VENUS0_VENUS_VBIF_OUT_AXI_AINNERSHARED_ADDR A:0x1d80174
y.create.l HWIO_VENUS0_VENUS_VBIF_OUT_AXI_AOOO_EN_ADDR A:0x1d80178
y.create.l HWIO_VENUS0_VENUS_VBIF_OUT_AXI_AOOO_ADDR A:0x1d8017c
y.create.l HWIO_VENUS0_VENUS_VBIF_OUT_AXI_ANOALLOCATE_ADDR A:0x1d80180
y.create.l HWIO_VENUS0_VENUS_VBIF_WD_TIMEOUT_ADDR A:0x1d80184
y.create.l HWIO_VENUS0_VENUS_VBIF_PND_ERR_ADDR A:0x1d80190
y.create.l HWIO_VENUS0_VENUS_VBIF_SRC_ERR_ADDR A:0x1d80194
y.create.l HWIO_VENUS0_VENUS_VBIF_ERR_MASK_ADDR A:0x1d80198
y.create.l HWIO_VENUS0_VENUS_VBIF_ERR_CLR_ADDR A:0x1d8019c
y.create.l HWIO_VENUS0_VENUS_VBIF_ERR_INFO_ADDR A:0x1d801a0
y.create.l HWIO_VENUS0_VENUS_VBIF_AXI_TEST_CTL_ADDR A:0x1d801b0
y.create.l HWIO_VENUS0_VENUS_VBIF_AXI_TEST_OUT_ADDR A:0x1d801b4
y.create.l HWIO_VENUS0_VENUS_VBIF_XIN_HALT_CTRL0_ADDR A:0x1d80200
y.create.l HWIO_VENUS0_VENUS_VBIF_XIN_HALT_CTRL1_ADDR A:0x1d80204
y.create.l HWIO_VENUS0_VENUS_VBIF_AXI_HALT_CTRL0_ADDR A:0x1d80208
y.create.l HWIO_VENUS0_VENUS_VBIF_AXI_HALT_CTRL1_ADDR A:0x1d8020c
y.create.l HWIO_VENUS0_VENUS_VBIF_TEST_BUS_OUT_CTRL_ADDR A:0x1d80210
y.create.l HWIO_VENUS0_VENUS_VBIF_TEST_BUS1_CTRL0_ADDR A:0x1d80214
y.create.l HWIO_VENUS0_VENUS_VBIF_TEST_BUS1_CTRL1_ADDR A:0x1d80218
y.create.l HWIO_VENUS0_VENUS_VBIF_TEST_BUS2_CTRL0_ADDR A:0x1d8021c
y.create.l HWIO_VENUS0_VENUS_VBIF_TEST_BUS2_CTRL1_ADDR A:0x1d80220
y.create.l HWIO_VENUS0_VENUS_VBIF_TEST_BUS_AHB_CTRL_ADDR A:0x1d8022c
y.create.l HWIO_VENUS0_VENUS_VBIF_TEST_BUS_OUT_ADDR A:0x1d80230
y.create.l HWIO_VENUS0_VENUS_VBIF_ATB_CONF0_ADDR A:0x1d80240
y.create.l HWIO_VENUS0_VENUS_VBIF_ATB_CONF1_ADDR A:0x1d80244
y.create.l HWIO_VENUS0_VENUS_VBIF_ATB_CONF2_ADDR A:0x1d80248
y.create.l HWIO_VENUS0_VENUS_VBIF_ATB_CONF3_ADDR A:0x1d8024c
y.create.l HWIO_VENUS0_VENUS_VBIF_ATB_TEST_VALUE_ADDR A:0x1d80250
y.create.l HWIO_VENUS0_VENUS_VBIF_STM_CONF_ADDR A:0x1d80260
y.create.l HWIO_VENUS0_VENUS_VBIF_WR_BUF_FOR_AP_ADDR A:0x1d80270
y.create.l HWIO_VENUS0_VENUS_VBIF_PERF_CNT_EN0_ADDR A:0x1d80300
y.create.l HWIO_VENUS0_VENUS_VBIF_PERF_CNT_EN1_ADDR A:0x1d80304
y.create.l HWIO_VENUS0_VENUS_VBIF_PERF_CNT_CLR0_ADDR A:0x1d80320
y.create.l HWIO_VENUS0_VENUS_VBIF_PERF_CNT_CLR1_ADDR A:0x1d80324
y.create.l HWIO_VENUS0_VENUS_VBIF_PERF_CNT_SEL0_ADDR A:0x1d80340
y.create.l HWIO_VENUS0_VENUS_VBIF_PERF_CNT_SEL1_ADDR A:0x1d80344
y.create.l HWIO_VENUS0_VENUS_VBIF_PERF_CNT_L0_ADDR A:0x1d80360
y.create.l HWIO_VENUS0_VENUS_VBIF_PERF_CNT_L1_ADDR A:0x1d80364
y.create.l HWIO_VENUS0_VENUS_VBIF_PERF_CNT_H0_ADDR A:0x1d80380
y.create.l HWIO_VENUS0_VENUS_VBIF_PERF_CNT_H1_ADDR A:0x1d80384
y.create.l HWIO_VENUS0_VENUS_VBIF_PERF_PWR_CNT_EN0_ADDR A:0x1d80400
y.create.l HWIO_VENUS0_VENUS_VBIF_PERF_PWR_CNT_EN1_ADDR A:0x1d80404
y.create.l HWIO_VENUS0_VENUS_VBIF_PERF_PWR_CNT_EN2_ADDR A:0x1d80408
y.create.l HWIO_VENUS0_VENUS_VBIF_PERF_PWR_CNT_CLR0_ADDR A:0x1d80420
y.create.l HWIO_VENUS0_VENUS_VBIF_PERF_PWR_CNT_CLR1_ADDR A:0x1d80424
y.create.l HWIO_VENUS0_VENUS_VBIF_PERF_PWR_CNT_CLR2_ADDR A:0x1d80428
y.create.l HWIO_VENUS0_VENUS_VBIF_PERF_PWR_CNT_L0_ADDR A:0x1d80440
y.create.l HWIO_VENUS0_VENUS_VBIF_PERF_PWR_CNT_L1_ADDR A:0x1d80444
y.create.l HWIO_VENUS0_VENUS_VBIF_PERF_PWR_CNT_L2_ADDR A:0x1d80448
y.create.l HWIO_VENUS0_VENUS_VBIF_PERF_PWR_CNT_H0_ADDR A:0x1d80460
y.create.l HWIO_VENUS0_VENUS_VBIF_PERF_PWR_CNT_H1_ADDR A:0x1d80464
y.create.l HWIO_VENUS0_VENUS_VBIF_PERF_PWR_CNT_H2_ADDR A:0x1d80468
y.create.l HWIO_VENUS0_VENUS_VBIF_MISR_CFG_A0_ADDR A:0x1d80480
y.create.l HWIO_VENUS0_VENUS_VBIF_MISR_COUNTER_ADDR A:0x1d80490
y.create.l HWIO_VENUS0_VENUS_VBIF_MISR_CLR_A0_ADDR A:0x1d80494
y.create.l HWIO_VENUS0_VENUS_VBIF_MISR_A0_SIG0_ADDR A:0x1d804a4
y.create.l HWIO_VENUS0_VENUS_VBIF_MISR_A0_SIG1_ADDR A:0x1d804a8
y.create.l HWIO_VENUS0_VENUS_VBIF_MISR_A0_SIG2_ADDR A:0x1d804ac
y.create.l HWIO_VENUS0_VENUS_VBIF_MISR_A0_SIG3_ADDR A:0x1d804b0
y.create.l HWIO_VENUS0_VENUS_VBIF_ADDR_TRANS_EN_ADDR A:0x1d81000
y.create.l HWIO_VENUS0_VENUS_VBIF_AT_OLD_BASE_ADDR A:0x1d81004
y.create.l HWIO_VENUS0_VENUS_VBIF_AT_OLD_HIGH_ADDR A:0x1d81008
y.create.l HWIO_VENUS0_VENUS_VBIF_AT_NEW_BASE_ADDR A:0x1d81010
y.create.l HWIO_VENUS0_VENUS_VBIF_AT_NEW_HIGH_ADDR A:0x1d81018
y.create.l HWIO_VENUS0_VENUS_VBIF_ATB_EN_ADDR A:0x1d81030
y.create.l HWIO_VENUS0_VENUS_VBIF_STM_EN_ADDR A:0x1d81040
y.create.l HWIO_VENUS0_VENUS_VBIF_DDR_OUTPUT_RECOVERABLE_HALT_CTRL0_ADDR A:0x1d82000
y.create.l HWIO_VENUS0_VENUS_VBIF_DDR_OUTPUT_RECOVERABLE_HALT_CTRL1_ADDR A:0x1d82004
y.create.l HWIO_VENUS0_VENUS_WRAPPER_HW_VERSION_ADDR A:0x1de0000
y.create.l HWIO_VENUS0_VENUS_WRAPPER_CLOCK_CONFIG_ADDR A:0x1de0004
y.create.l HWIO_VENUS0_VENUS_WRAPPER_EFUSE_MONITOR_ADDR A:0x1de0008
y.create.l HWIO_VENUS0_VENUS_WRAPPER_INTR_STATUS_ADDR A:0x1de000c
y.create.l HWIO_VENUS0_VENUS_WRAPPER_INTR_MASK_ADDR A:0x1de0010
y.create.l HWIO_VENUS0_VENUS_WRAPPER_INTR_CLEAR_ADDR A:0x1de0014
y.create.l HWIO_VENUS0_VENUS_WRAPPER_VBIF_REQ_PRIORITY_ADDR A:0x1de0020
y.create.l HWIO_VENUS0_VENUS_WRAPPER_VBIF_PRIORITY_LEVEL_ADDR A:0x1de0024
y.create.l HWIO_VENUS0_VENUS_WRAPPER_VBIF_ATID_ADDR A:0x1de0030
y.create.l HWIO_VENUS0_VENUS_WRAPPER_VBIF_ATB_SEL_ADDR A:0x1de0034
y.create.l HWIO_VENUS0_VENUS_WRAPPER_VBIF_MUX_SEL_ADDR A:0x1de0038
y.create.l HWIO_VENUS0_VENUS_WRAPPER_TEST_BUS_SEL_ADDR A:0x1de0040
y.create.l HWIO_VENUS0_VENUS_WRAPPER_MMCC_VENUS0_POWER_STATUS_ADDR A:0x1de0044
y.create.l HWIO_VENUS0_VENUS_WRAPPER_VENUS0_MMCC_VDEC_VCODEC_POWER_CONTROL_ADDR A:0x1de0048
y.create.l HWIO_VENUS0_VENUS_WRAPPER_VENUS0_MMCC_VENC_POWER_CONTROL_ADDR A:0x1de004c
y.create.l HWIO_VENUS0_VENUS_WRAPPER_MODE_OF_OPERATION_ADDR A:0x1de0050
y.create.l HWIO_VENUS0_VENUS_WRAPPER_VDMA_COMMON_CTRL_ADDR A:0x1de0054
y.create.l HWIO_VENUS0_VENUS_WRAPPER_DANGER_LEVEL_DEC_ADDR A:0x1de0058
y.create.l HWIO_VENUS0_VENUS_WRAPPER_DANGER_LEVEL_ENC_ADDR A:0x1de005c
y.create.l HWIO_VENUS0_VENUS_WRAPPER_ERR_STATUS_ADDR A:0x1de0060
y.create.l HWIO_VENUS0_VENUS_WRAPPER_SPARE_ADDR A:0x1de0ffc
y.create.l HWIO_VENUS0_VENUS_WRAPPER_VBIF_SS_SEC_SID_0_SECURE_ADDR A:0x1de1000
y.create.l HWIO_VENUS0_VENUS_WRAPPER_VBIF_SS_SEC_SID_1_SECURE_ADDR A:0x1de1004
y.create.l HWIO_VENUS0_VENUS_WRAPPER_VBIF_SS_SEC_SID_2_SECURE_ADDR A:0x1de1008
y.create.l HWIO_VENUS0_VENUS_WRAPPER_VBIF_SS_SEC_SID_3_SECURE_ADDR A:0x1de100c
y.create.l HWIO_VENUS0_VENUS_WRAPPER_VBIF_SS_SEC_SID_4_SECURE_ADDR A:0x1de1010
y.create.l HWIO_VENUS0_VENUS_WRAPPER_VBIF_SS_SEC_SID_5_SECURE_ADDR A:0x1de1014
y.create.l HWIO_VENUS0_VENUS_WRAPPER_VBIF_SS_SEC_SID_6_SECURE_ADDR A:0x1de1018
y.create.l HWIO_VENUS0_VENUS_WRAPPER_VBIF_SS_SEC_SID_7_SECURE_ADDR A:0x1de101c
y.create.l HWIO_VENUS0_VENUS_WRAPPER_VBIF_SS_SEC_CPA_START_ADDR_ADDR A:0x1de1020
y.create.l HWIO_VENUS0_VENUS_WRAPPER_VBIF_SS_SEC_CPA_END_ADDR_ADDR A:0x1de1024
y.create.l HWIO_VENUS0_VENUS_WRAPPER_VBIF_SS_SEC_FW_START_ADDR_ADDR A:0x1de1028
y.create.l HWIO_VENUS0_VENUS_WRAPPER_VBIF_SS_SEC_FW_END_ADDR_ADDR A:0x1de102c
y.create.l HWIO_VENUS0_VENUS_WRAPPER_VBIF_SS_SEC_NONPIX_START_ADDR_ADDR A:0x1de1030
y.create.l HWIO_VENUS0_VENUS_WRAPPER_VBIF_SS_SEC_NONPIX_END_ADDR_ADDR A:0x1de1034
y.create.l HWIO_VENUS0_VENUS_WRAPPER_VBIF_SS_SEC_SID_8_SECURE_ADDR A:0x1de1040
y.create.l HWIO_VENUS0_VENUS_WRAPPER_VBIF_SS_SEC_SID_9_SECURE_ADDR A:0x1de1044
y.create.l HWIO_VENUS0_VENUS_WRAPPER_VBIF_SS_SEC_SID_A_SECURE_ADDR A:0x1de1048
y.create.l HWIO_VENUS0_VENUS_WRAPPER_VBIF_SS_SEC_SID_B_SECURE_ADDR A:0x1de104c
y.create.l HWIO_VENUS0_VENUS_WRAPPER_VBIF_SS_SEC_SID_C_SECURE_ADDR A:0x1de1050
y.create.l HWIO_VENUS0_VENUS_WRAPPER_VBIF_SS_SEC_SID_D_SECURE_ADDR A:0x1de1054
y.create.l HWIO_VENUS0_VENUS_WRAPPER_VBIF_SS_SEC_SID_E_SECURE_ADDR A:0x1de1058
y.create.l HWIO_VENUS0_VENUS_WRAPPER_SEC_CSR0_ADDR A:0x1de1080
y.create.l HWIO_VENUS0_VENUS_WRAPPER_SEC_CSR1_ADDR A:0x1de1084
y.create.l HWIO_VENUS0_VENUS_WRAPPER_SEC_CSR2_ADDR A:0x1de1088
y.create.l HWIO_VENUS0_VENUS_WRAPPER_SEC_CSR3_ADDR A:0x1de108c
y.create.l HWIO_VENUS0_VENUS_WRAPPER_SEC_CSR4_ADDR A:0x1de1090
y.create.l HWIO_VENUS0_VENUS_WRAPPER_SEC_CSR5_ADDR A:0x1de1094
y.create.l HWIO_VENUS0_VENUS_WRAPPER_SEC_CSR6_ADDR A:0x1de1098
y.create.l HWIO_VENUS0_VENUS_WRAPPER_SEC_CSR7_ADDR A:0x1de109c
y.create.l HWIO_VENUS0_VENUS_WRAPPER_VBIF_SS_CP_OVERRIDE_DEC_RO_ADDR A:0x1de10a0
y.create.l HWIO_VENUS0_VENUS_WRAPPER_VBIF_SS_CP_OVERRIDE_ENC_RO_ADDR A:0x1de10a4
y.create.l HWIO_VENUS0_VENUS_WRAPPER_VBIF_SS_SEC_SID_0_SECURE_OVERRIDE_RO_ADDR A:0x1de10a8
y.create.l HWIO_VENUS0_VENUS_WRAPPER_VBIF_SS_SEC_SID_1_SECURE_OVERRIDE_RO_ADDR A:0x1de10ac
y.create.l HWIO_VENUS0_VENUS_WRAPPER_VBIF_SS_SEC_SID_2_SECURE_OVERRIDE_RO_ADDR A:0x1de10b0
y.create.l HWIO_VENUS0_VENUS_WRAPPER_VBIF_SS_SEC_SID_3_SECURE_OVERRIDE_RO_ADDR A:0x1de10b4
y.create.l HWIO_VENUS0_VENUS_WRAPPER_VBIF_SS_SEC_SID_4_SECURE_OVERRIDE_RO_ADDR A:0x1de10b8
y.create.l HWIO_VENUS0_VENUS_WRAPPER_VBIF_SS_SEC_SID_5_SECURE_OVERRIDE_RO_ADDR A:0x1de10bc
y.create.l HWIO_VENUS0_VENUS_WRAPPER_VBIF_SS_SEC_SID_6_SECURE_OVERRIDE_RO_ADDR A:0x1de10c0
y.create.l HWIO_VENUS0_VENUS_WRAPPER_VBIF_SS_SEC_SID_7_SECURE_OVERRIDE_RO_ADDR A:0x1de10c4
y.create.l HWIO_VENUS0_VENUS_WRAPPER_VBIF_SS_SEC_SID_8_SECURE_OVERRIDE_RO_ADDR A:0x1de10c8
y.create.l HWIO_VENUS0_VENUS_WRAPPER_VBIF_SS_SEC_SID_9_SECURE_OVERRIDE_RO_ADDR A:0x1de10cc
y.create.l HWIO_VENUS0_VENUS_WRAPPER_VBIF_SS_SEC_SID_A_SECURE_OVERRIDE_RO_ADDR A:0x1de10d0
y.create.l HWIO_VENUS0_VENUS_WRAPPER_VBIF_SS_SEC_SID_B_SECURE_OVERRIDE_RO_ADDR A:0x1de10d4
y.create.l HWIO_VENUS0_VENUS_WRAPPER_VBIF_SS_SEC_SID_C_SECURE_OVERRIDE_RO_ADDR A:0x1de10d8
y.create.l HWIO_VENUS0_VENUS_WRAPPER_VBIF_SS_SEC_SID_D_SECURE_OVERRIDE_RO_ADDR A:0x1de10dc
y.create.l HWIO_VENUS0_VENUS_WRAPPER_VBIF_SS_SEC_SID_E_SECURE_OVERRIDE_RO_ADDR A:0x1de10e0
y.create.l HWIO_VENUS0_VENUS_WRAPPER_VBIF_SS_CP_VP8_SECURE_OVERRIDE_DEC_RO_ADDR A:0x1de10e4
y.create.l HWIO_VENUS0_VENUS_WRAPPER_VBIF_SS_CP_VP9_SECURE_OVERRIDE_DEC_RO_ADDR A:0x1de10e8
y.create.l HWIO_VENUS0_VENUS_WRAPPER_VBIF_SS_SEC_DS_THRESHOLD_RO_ADDR A:0x1de10ec
y.create.l HWIO_VENUS0_VENUS_WRAPPER_VBIF_SS_CCE_THREAD0_OPMODE_ADDR A:0x1de10f0
y.create.l HWIO_VENUS0_VENUS_WRAPPER_VBIF_SS_SDE_THREAD_OPMODE_ADDR A:0x1de10f4
y.create.l HWIO_VENUS0_VENUS_WRAPPER_VBIF_SS_VPP_THREAD_OPMODE_ADDR A:0x1de10f8
y.create.l HWIO_VENUS0_VENUS_WRAPPER_SPARE_1_ADDR A:0x1de10fc
y.create.l HWIO_VENUS0_VENUS_WRAPPER_SPARE_2_ADDR A:0x1de1100
y.create.l HWIO_VENUS0_VENUS_WRAPPER_SPARE_3_ADDR A:0x1de1104
y.create.l HWIO_VENUS0_VENUS_WRAPPER_CPU_CLOCK_CONFIG_ADDR A:0x1de2000
y.create.l HWIO_VENUS0_VENUS_WRAPPER_AXI_HALT_ADDR A:0x1de2008
y.create.l HWIO_VENUS0_VENUS_WRAPPER_AXI_HALT_STATUS_ADDR A:0x1de200c
y.create.l HWIO_VENUS0_VENUS_WRAPPER_CPU_CGC_DIS_ADDR A:0x1de2010
y.create.l HWIO_VENUS0_VENUS_WRAPPER_CPU_STATUS_ADDR A:0x1de2014
y.create.l HWIO_VENUS0_VENUS_WRAPPER_SW_RESET_ADDR A:0x1de3000
y.create.l HWIO_VENUS0_VENUS_WRAPPER_VBIF_SS_CP_OVERRIDE_DEC_ADDR A:0x1de3004
y.create.l HWIO_VENUS0_VENUS_WRAPPER_VBIF_SS_CP_OVERRIDE_ENC_ADDR A:0x1de3008
y.create.l HWIO_VENUS0_VENUS_WRAPPER_VBIF_SS_SEC_SID_0_SECURE_OVERRIDE_ADDR A:0x1de3010
y.create.l HWIO_VENUS0_VENUS_WRAPPER_VBIF_SS_SEC_SID_1_SECURE_OVERRIDE_ADDR A:0x1de3014
y.create.l HWIO_VENUS0_VENUS_WRAPPER_VBIF_SS_SEC_SID_2_SECURE_OVERRIDE_ADDR A:0x1de3018
y.create.l HWIO_VENUS0_VENUS_WRAPPER_VBIF_SS_SEC_SID_3_SECURE_OVERRIDE_ADDR A:0x1de301c
y.create.l HWIO_VENUS0_VENUS_WRAPPER_VBIF_SS_SEC_SID_4_SECURE_OVERRIDE_ADDR A:0x1de3020
y.create.l HWIO_VENUS0_VENUS_WRAPPER_VBIF_SS_SEC_SID_5_SECURE_OVERRIDE_ADDR A:0x1de3024
y.create.l HWIO_VENUS0_VENUS_WRAPPER_VBIF_SS_SEC_SID_6_SECURE_OVERRIDE_ADDR A:0x1de3028
y.create.l HWIO_VENUS0_VENUS_WRAPPER_VBIF_SS_SEC_SID_7_SECURE_OVERRIDE_ADDR A:0x1de302c
y.create.l HWIO_VENUS0_VENUS_WRAPPER_VBIF_SS_SEC_SID_8_SECURE_OVERRIDE_ADDR A:0x1de3030
y.create.l HWIO_VENUS0_VENUS_WRAPPER_VBIF_SS_SEC_SID_9_SECURE_OVERRIDE_ADDR A:0x1de3034
y.create.l HWIO_VENUS0_VENUS_WRAPPER_VBIF_SS_SEC_SID_A_SECURE_OVERRIDE_ADDR A:0x1de3038
y.create.l HWIO_VENUS0_VENUS_WRAPPER_VBIF_SS_SEC_SID_B_SECURE_OVERRIDE_ADDR A:0x1de303c
y.create.l HWIO_VENUS0_VENUS_WRAPPER_VBIF_SS_SEC_SID_C_SECURE_OVERRIDE_ADDR A:0x1de3040
y.create.l HWIO_VENUS0_VENUS_WRAPPER_VBIF_SS_SEC_SID_D_SECURE_OVERRIDE_ADDR A:0x1de3044
y.create.l HWIO_VENUS0_VENUS_WRAPPER_VBIF_SS_SEC_SID_E_SECURE_OVERRIDE_ADDR A:0x1de3048
y.create.l HWIO_VENUS0_VENUS_WRAPPER_VBIF_SS_SEC_THRESHOLD_HEVC_ADDR A:0x1de304c
y.create.l HWIO_VENUS0_VENUS_WRAPPER_VBIF_SS_SEC_THRESHOLD_H264_ADDR A:0x1de3050
y.create.l HWIO_VENUS0_VENUS_WRAPPER_VBIF_SS_SEC_THRESHOLD_VC1_AP_ADDR A:0x1de3054
y.create.l HWIO_VENUS0_VENUS_WRAPPER_VBIF_SS_SEC_THRESHOLD_MP2_ADDR A:0x1de3058
y.create.l HWIO_VENUS0_VENUS_WRAPPER_VBIF_SS_SEC_THRESHOLD_MP4_ADDR A:0x1de305c
y.create.l HWIO_VENUS0_VENUS_WRAPPER_VBIF_SS_SEC_THRESHOLD_H263_ADDR A:0x1de3060
y.create.l HWIO_VENUS0_VENUS_WRAPPER_VBIF_SS_SEC_THRESHOLD_VP8_ADDR A:0x1de3064
y.create.l HWIO_VENUS0_VENUS_WRAPPER_VBIF_SS_SEC_THRESHOLD_VP9_ADDR A:0x1de3068
y.create.l HWIO_VENUS0_VENUS_WRAPPER_VBIF_SS_SEC_THRESHOLD_NON_VCL_HEVC_ADDR A:0x1de306c
y.create.l HWIO_VENUS0_VENUS_WRAPPER_VBIF_SS_SEC_THRESHOLD_NON_VCL_H264_ADDR A:0x1de3070
y.create.l HWIO_VENUS0_VENUS_WRAPPER_VBIF_SS_SEC_THRESHOLD_NON_VCL_MP4_ADDR A:0x1de3074
y.create.l HWIO_VENUS0_VENUS_WRAPPER_VBIF_SS_SEC_THRESHOLD_NON_VCL_MP2_ADDR A:0x1de3078
y.create.l HWIO_VENUS0_VENUS_WRAPPER_VBIF_SS_SEC_THRESHOLD_NON_VCL_VC1_AP_ADDR A:0x1de307c
y.create.l HWIO_VENUS0_VENUS_WRAPPER_VBIF_SS_SEC_THRESHOLD_NON_VCL_H263_ADDR A:0x1de3080
y.create.l HWIO_VENUS0_VENUS_WRAPPER_VBIF_SS_SEC_DS_THRESHOLD_ADDR A:0x1de3084
y.create.l HWIO_VENUS0_VENUS_WRAPPER_VBIF_SS_CP_VP8_SECURE_OVERRIDE_DEC_ADDR A:0x1de3088
y.create.l HWIO_VENUS0_VENUS_WRAPPER_VBIF_SS_CP_VP9_SECURE_OVERRIDE_DEC_ADDR A:0x1de308c
y.create.l HWIO_VENUS0_VENUS_WRAPPER_VBIF_SS_CP_VP8_INSERTED_SC_DEC_ADDR A:0x1de3090
y.create.l HWIO_VENUS0_VENUS_WRAPPER_VBIF_SS_CP_VP9_INSERTED_SC_DEC_ADDR A:0x1de3094
y.create.l HWIO_VENUS0_VENUS_XPU_SCR_ADDR A:0x1df0000
y.create.l HWIO_VENUS0_VENUS_XPU_SWDR_ADDR A:0x1df0004
y.create.l HWIO_VENUS0_VENUS_XPU_SEAR0_ADDR A:0x1df0040
y.create.l HWIO_VENUS0_VENUS_XPU_SESR_ADDR A:0x1df0048
y.create.l HWIO_VENUS0_VENUS_XPU_SESRRESTORE_ADDR A:0x1df004c
y.create.l HWIO_VENUS0_VENUS_XPU_SESYNR0_ADDR A:0x1df0050
y.create.l HWIO_VENUS0_VENUS_XPU_SESYNR1_ADDR A:0x1df0054
y.create.l HWIO_VENUS0_VENUS_XPU_SESYNR2_ADDR A:0x1df0058
y.create.l HWIO_VENUS0_VENUS_XPU_MCR_ADDR A:0x1df0100
y.create.l HWIO_VENUS0_VENUS_XPU_MEAR0_ADDR A:0x1df0140
y.create.l HWIO_VENUS0_VENUS_XPU_MESR_ADDR A:0x1df0148
y.create.l HWIO_VENUS0_VENUS_XPU_MESRRESTORE_ADDR A:0x1df014c
y.create.l HWIO_VENUS0_VENUS_XPU_MESYNR0_ADDR A:0x1df0150
y.create.l HWIO_VENUS0_VENUS_XPU_MESYNR1_ADDR A:0x1df0154
y.create.l HWIO_VENUS0_VENUS_XPU_MESYNR2_ADDR A:0x1df0158
y.create.l HWIO_VENUS0_VENUS_XPU_CR_ADDR A:0x1df0080
y.create.l HWIO_VENUS0_VENUS_XPU_RPU_ACR0_ADDR A:0x1df00a0
y.create.l HWIO_VENUS0_VENUS_XPU_EAR0_ADDR A:0x1df00c0
y.create.l HWIO_VENUS0_VENUS_XPU_ESR_ADDR A:0x1df00c8
y.create.l HWIO_VENUS0_VENUS_XPU_ESRRESTORE_ADDR A:0x1df00cc
y.create.l HWIO_VENUS0_VENUS_XPU_ESYNR0_ADDR A:0x1df00d0
y.create.l HWIO_VENUS0_VENUS_XPU_ESYNR1_ADDR A:0x1df00d4
y.create.l HWIO_VENUS0_VENUS_XPU_ESYNR2_ADDR A:0x1df00d8
y.create.l HWIO_VENUS0_VENUS_XPU_IDR0_ADDR A:0x1df0074
y.create.l HWIO_VENUS0_VENUS_XPU_IDR1_ADDR A:0x1df0078
y.create.l HWIO_VENUS0_VENUS_XPU_REV_ADDR A:0x1df007c
y.create.l HWIO_VENUS0_VENUS_XPU_RG0_RACR0_ADDR A:0x1df0200
y.create.l HWIO_VENUS0_VENUS_XPU_RG1_RACR0_ADDR A:0x1df0280
y.create.l HWIO_VENUS0_VENUS_XPU_RG2_RACR0_ADDR A:0x1df0300
y.create.l HWIO_VENUS0_VENUS_XPU_RG0_WACR0_ADDR A:0x1df0220
y.create.l HWIO_VENUS0_VENUS_XPU_RG1_WACR0_ADDR A:0x1df02a0
y.create.l HWIO_VENUS0_VENUS_XPU_RG2_WACR0_ADDR A:0x1df0320
y.create.l HWIO_VENUS0_VENUS_XPU_RG0_SCR_ADDR A:0x1df0250
y.create.l HWIO_VENUS0_VENUS_XPU_RG1_SCR_ADDR A:0x1df02d0
y.create.l HWIO_VENUS0_VENUS_XPU_RG2_SCR_ADDR A:0x1df0350
y.create.l HWIO_VENUS0_VENUS_XPU_RG0_MCR_ADDR A:0x1df0254
y.create.l HWIO_VENUS0_VENUS_XPU_RG1_MCR_ADDR A:0x1df02d4
y.create.l HWIO_VENUS0_VENUS_XPU_RG2_MCR_ADDR A:0x1df0354
y.create.l HWIO_WCSS_A_BT_SYSCLK_CMPR_EN_ADDR A:0xa440050
y.create.l HWIO_WCSS_A_BT_SYSCLK_CMPR_INTGR_ADDR A:0xa440054
y.create.l HWIO_WCSS_A_BT_SYSCLK_CMPR_FRACT_ADDR A:0xa440058
y.create.l HWIO_WCSS_A_BT_SYSCLK_COUNTVAL_ADDR A:0xa440070
y.create.l HWIO_WCSS_A_BT_SYSCLK_DEBUG_SEL_ADDR A:0xa4400cc
y.create.l HWIO_WCSS_A_BT_SYSCLK_DEBUG_CONTROL_1_ADDR A:0xa4400d4
y.create.l HWIO_WCSS_A_BT_SYSCLK_DEBUG_CONTROL_2_ADDR A:0xa4400d8
y.create.l HWIO_WCSS_A_BT_SYSCLK_CONTROL_ADDR A:0xa440100
y.create.l HWIO_WCSS_A_BT_SYSCLK_COMPLETE_ADDR A:0xa440104
y.create.l HWIO_WCSS_A_BT_SYSCLK_CLKN_CAPTURE_CTL_ADDR A:0xa440120
y.create.l HWIO_WCSS_A_BT_SYSCLK_CLKN_CAPTURE_INTEGER_VAL_ADDR A:0xa440124
y.create.l HWIO_WCSS_A_BT_SYSCLK_CLKN_CAPTURE_FRACT_VAL_ADDR A:0xa440128
y.create.l HWIO_WCSS_A_BT_SYSCLK_MASTER_MEM_ADDR_ADDR A:0xa440130
y.create.l HWIO_WCSS_A_BT_SYSCLK_SLAVE_BT_ADDR_ADDR A:0xa440134
y.create.l HWIO_WCSS_A_BT_SYSCLK_PVC_SSBI2_INTR_ADDR A:0xa4400a0
y.create.l HWIO_WCSS_A_BT_INT_0_INTERRUPT_CONTROL_ADDR A:0xa3ff000
y.create.l HWIO_WCSS_A_BT_INT_0_BTC_INTERRUPT_MASK_ADDR A:0xa3ff004
y.create.l HWIO_WCSS_A_BT_INT_0_BTC_INTERRUPT_STATUS_AND_ACKNOWLEDGE_ADDR A:0xa3ff008
y.create.l HWIO_WCSS_A_BT_INT_0_BTC_PRESLOT_FILTER_ADDR A:0xa3ff00c
y.create.l HWIO_WCSS_A_BT_INT_0_BTC_SLOT_BURST_TIMER_ADDR A:0xa3ff010
y.create.l HWIO_WCSS_A_BT_BLUETOOTH_CLOCK_N_COMPARATOR_INTERRUPT_CONTROL_STATUS_ADDR A:0xa3ff014
y.create.l HWIO_WCSS_A_BT_CAPTURED_BT_CLKN_INTEGER_PORTION_ADDR A:0xa3ff018
y.create.l HWIO_WCSS_A_BT_CAPTURED_BT_CLKN_FRACTIONAL_PORTION_ADDR A:0xa3ff01c
y.create.l HWIO_WCSS_A_BT_CAPTURED_BT_CLKA_INTEGER_PORTION_ADDR A:0xa3ff020
y.create.l HWIO_WCSS_A_BT_CAPTURED_BT_CLKA_FRACTIONAL_PORTION_ADDR A:0xa3ff024
y.create.l HWIO_WCSS_A_BT_BT_CLOCK_CONTROL_ADDR A:0xa3ff028
y.create.l HWIO_WCSS_A_BT_BT_CLOCK_ALU_COMMAND_ADDR A:0xa3ff02c
y.create.l HWIO_WCSS_A_BT_BT_CLOCK_ALU_INTEGER_OPERAND_ADDR A:0xa3ff030
y.create.l HWIO_WCSS_A_BT_BT_CLOCK_ALU_FRACTIONAL_OPERAND_ADDR A:0xa3ff034
y.create.l HWIO_WCSS_A_BT_BT_CLOCK_ALU_INTEGER_ACCUMULATOR_ADDR A:0xa3ff038
y.create.l HWIO_WCSS_A_BT_BT_CLOCK_ALU_FRACTIONAL_ACCUMULATOR_ADDR A:0xa3ff03c
y.create.l HWIO_WCSS_A_BT_LTE_FRAME_SYNC_CAPTURED_BT_CLKN_INTEGER_PORTION_ADDR A:0xa3ff040
y.create.l HWIO_WCSS_A_BT_LTE_FRAME_SYNC_CAPTURED_BT_CLKN_FRACTIONAL_PORTION_ADDR A:0xa3ff044
y.create.l HWIO_WCSS_A_BT_ENCRYPTION_CONTROL_ADDR A:0xa3ff048
y.create.l HWIO_WCSS_A_BT_ENCRYPTION_K_C_KEY_0_LE_SESSION_KEY_0_ADDR A:0xa3ff04c
y.create.l HWIO_WCSS_A_BT_ENCRYPTION_K_C_KEY_1_LE_SESSION_KEY_1_ADDR A:0xa3ff050
y.create.l HWIO_WCSS_A_BT_ENCRYPTION_K_C_KEY_2_LE_SESSION_KEY_2_ADDR A:0xa3ff054
y.create.l HWIO_WCSS_A_BT_ENCRYPTION_K_C_KEY_3_LE_SESSION_KEY_3_ADDR A:0xa3ff058
y.create.l HWIO_WCSS_A_BT_CAPTURED_UAP_ADDR A:0xa3ff05c
y.create.l HWIO_WCSS_A_BT_BT_DEVICE_ADDRESS_0_ADDR A:0xa3ff060
y.create.l HWIO_WCSS_A_BT_BT_DEVICE_ADDRESS_1_ADDR A:0xa3ff064
y.create.l HWIO_WCSS_A_BT_HOP_CONTROL_ADDR A:0xa3ff068
y.create.l HWIO_WCSS_A_BT_HOP_N_COUNT_ADDR A:0xa3ff06c
y.create.l HWIO_WCSS_A_BT_HOP_OFFSET_ADDR A:0xa3ff070
y.create.l HWIO_WCSS_A_BT_HOP_COEXISTENCE_LOW_CHANNEL_ADDR A:0xa3ff074
y.create.l HWIO_WCSS_A_BT_HOP_COEXISTENCE_HIGH_CHANNEL_ADDR A:0xa3ff078
y.create.l HWIO_WCSS_A_BT_HOP_AFH_CHANNEL_MAP_0_ADDR A:0xa3ff07c
y.create.l HWIO_WCSS_A_BT_HOP_AFH_CHANNEL_MAP_1_ADDR A:0xa3ff080
y.create.l HWIO_WCSS_A_BT_HOP_AFH_CHANNEL_MAP_2_ADDR A:0xa3ff084
y.create.l HWIO_WCSS_A_BT_HOP_HALF_SLOT_0_BCA_CHANNEL_ADDR A:0xa3ff088
y.create.l HWIO_WCSS_A_BT_HOP_HALF_SLOT_1_BCA_CHANNEL_ADDR A:0xa3ff08c
y.create.l HWIO_WCSS_A_BT_HOP_FREQUENCY_ADDR A:0xa3ff090
y.create.l HWIO_WCSS_A_BT_LE_CHANNEL_INDEX_ADDR A:0xa3ff094
y.create.l HWIO_WCSS_A_BT_HOP_FREQUENCY_1_ADDR A:0xa3ff098
y.create.l HWIO_WCSS_A_BT_LC_COMMAND_HALF_SLOT_0_ADDR A:0xa3ff0a0
y.create.l HWIO_WCSS_A_BT_LC_COMMAND_HALF_SLOT_1_ADDR A:0xa3ff0a4
y.create.l HWIO_WCSS_A_BT_LC_ABORT_ISSUE_AND_STATUS_ADDR A:0xa3ff0a8
y.create.l HWIO_WCSS_A_BT_LLR_TRIGGER_REPETITION_ADDR A:0xa3ff0ac
y.create.l HWIO_WCSS_A_BT_RX_CONTROL_ADDR A:0xa3ff0b0
y.create.l HWIO_WCSS_A_BT_RX_NORMAL_APERTURE_WINDOW_ADDR A:0xa3ff0b4
y.create.l HWIO_WCSS_A_BT_RX_WIDE_APERTURE_WINDOW_ADDR A:0xa3ff0b8
y.create.l HWIO_WCSS_A_BT_RX_BCA_WINDOW_ADDR A:0xa3ff0bc
y.create.l HWIO_WCSS_A_BT_SW_WHITEN_SEED_ADDR A:0xa3ff0c0
y.create.l HWIO_WCSS_A_BT_RX_ACL_HEADER_THRESHOLD_ADDR A:0xa3ff0c4
y.create.l HWIO_WCSS_A_BT_RX_SCO_HEADER_THRESHOLD_ADDR A:0xa3ff0c8
y.create.l HWIO_WCSS_A_BT_HOP_OFFSET_1_ADDR A:0xa3ff0cc
y.create.l HWIO_WCSS_A_BT_RX_SYNC_WORD_0_ADDR A:0xa3ff0d0
y.create.l HWIO_WCSS_A_BT_RX_SYNC_WORD_1_ADDR A:0xa3ff0d4
y.create.l HWIO_WCSS_A_BT_RX_SCO_PAYLOAD_LENGTH_ADDR A:0xa3ff0d8
y.create.l HWIO_WCSS_A_BT_RX_AM_ADDRESS_ARRAY_POINTER_ADDR A:0xa3ff0dc
y.create.l HWIO_WCSS_A_BT_RX_BUFFER_SCO_POINTER_ADDR A:0xa3ff0e0
y.create.l HWIO_WCSS_A_BT_RX_BUFFER_ACL_POINTER_ADDR A:0xa3ff0e4
y.create.l HWIO_WCSS_A_BT_RX_BUFFER_LMP_POINTER_ADDR A:0xa3ff0e8
y.create.l HWIO_WCSS_A_BT_RX_BUFFER_CONTROL_POINTER_ADDR A:0xa3ff0ec
y.create.l HWIO_WCSS_A_BT_RX_BUFFER_LE_POINTER_ADDR A:0xa3ff0f0
y.create.l HWIO_WCSS_A_BT_RX_LOW_POWER_CONTROL_ADDR A:0xa3ff0f4
y.create.l HWIO_WCSS_A_BT_RX_LPPS_BIST_TIMER_INIT_VALUE_ADDR A:0xa3ff0f8
y.create.l HWIO_WCSS_A_BT_SYNC_WORD_ADDR A:0xa3ff0fc
y.create.l HWIO_WCSS_A_BT_RX_COMPOSITE_STATUS_ADDR A:0xa3ff100
y.create.l HWIO_WCSS_A_BT_RX_DETAILED_BAD_STATUS_ADDR A:0xa3ff104
y.create.l HWIO_WCSS_A_BT_RX_FEC_AND_DONE_STATUS_ADDR A:0xa3ff108
y.create.l HWIO_WCSS_A_BT_RX_FRAME_TIMING_ERROR_ADDR A:0xa3ff10c
y.create.l HWIO_WCSS_A_BT_RX_PACKET_HEADER_ERROR_COUNT_ADDR A:0xa3ff11c
y.create.l HWIO_WCSS_A_BT_RX_PAYLOAD_2_3_FEC_ERROR_DETECTED_COUNT_ADDR A:0xa3ff124
y.create.l HWIO_WCSS_A_BT_RX_PAYLOAD_FEC_ERROR_CORRECTED_COUNT_ADDR A:0xa3ff128
y.create.l HWIO_WCSS_A_BT_RX_ENERGY_DETECT_COUNT_ADDR A:0xa3ff12c
y.create.l HWIO_WCSS_A_BT_RX_LE_PAYLOAD_HEADER_DATA_ADDR A:0xa3ff134
y.create.l HWIO_WCSS_A_BT_RX_PACKET_HEADER_DATA_ADDR A:0xa3ff138
y.create.l HWIO_WCSS_A_BT_RX_PAYLOAD_HEADER_DATA_ADDR A:0xa3ff13c
y.create.l HWIO_WCSS_A_BT_RX_PACKET_HEADER_HEC_ADDR A:0xa3ff144
y.create.l HWIO_WCSS_A_BT_RX_PAYLOAD_CRC_ADDR A:0xa3ff148
y.create.l HWIO_WCSS_A_BT_TX_SCO_PAYLOAD_LENGTH_ADDR A:0xa3ff14c
y.create.l HWIO_WCSS_A_BT_TX_BUFFER_POINTER_ADDR A:0xa3ff150
y.create.l HWIO_WCSS_A_BT_TX_STATUS_ADDR A:0xa3ff158
y.create.l HWIO_WCSS_A_BT_COEXISTENCE_RF_ACTIVE_DELAY_TIMER_ADDR A:0xa3ff15c
y.create.l HWIO_WCSS_A_BT_SOFTWARE_CAPTURE_CALCULATE_COMMAND_ADDR A:0xa3ff160
y.create.l HWIO_WCSS_A_BT_COEXISTENCE_COMMAND_ADDR A:0xa3ff164
y.create.l HWIO_WCSS_A_BT_COEXISTENCE_CONTROL_ADDR A:0xa3ff168
y.create.l HWIO_WCSS_A_BT_COEXISTENCE_ENABLE_AND_POLARITY_ADDR A:0xa3ff16c
y.create.l HWIO_WCSS_A_BT_COEXISTENCE_STATUS_ADDR A:0xa3ff170
y.create.l HWIO_WCSS_A_BT_TEST_MUX_CONTROL_ADDR A:0xa3ff178
y.create.l HWIO_WCSS_A_BT_TEST_MUX_DEBUG_OUTPUT_ADDR A:0xa3ff17c
y.create.l HWIO_WCSS_A_BT_HARDWARE_VERIFICATION_CONTROL_1_ADDR A:0xa3ff184
y.create.l HWIO_WCSS_A_BT_HARDWARE_VERIFICATION_CONTROL_2_ADDR A:0xa3ff188
y.create.l HWIO_WCSS_A_BT_HARDWARE_VERIFICATION_CONTROL_3_ADDR A:0xa3ff18c
y.create.l HWIO_WCSS_A_BT_HARDWARE_VERIFICATION_CLEAR_STATE_MACHINES_ADDR A:0xa3ff190
y.create.l HWIO_WCSS_A_BT_HARDWARE_VERIFICATION_STATUS_1_ADDR A:0xa3ff194
y.create.l HWIO_WCSS_A_BT_HARDWARE_VERIFICATION_STATUS_2_ADDR A:0xa3ff198
y.create.l HWIO_WCSS_A_BT_BT_CORE_VERSION_ADDR A:0xa3ff19c
y.create.l HWIO_WCSS_A_BT_PACKET_CONTROL_ADDR A:0xa3ff1a0
y.create.l HWIO_WCSS_A_BT_TEST_CONTROL_ADDR A:0xa3ff1a4
y.create.l HWIO_WCSS_A_BT_LE_CONTROL_2_ADDR A:0xa3ff1a8
y.create.l HWIO_WCSS_A_BT_BLUETOOTH_CLOCK_N_INTEGER_COMPARE_VALUE_0_ADDR A:0xa3ff1ac
y.create.l HWIO_WCSS_A_BT_BLUETOOTH_CLOCK_N_FRACTIONAL_COMPARE_VALUE_0_ADDR A:0xa3ff1b0
y.create.l HWIO_WCSS_A_BT_BLUETOOTH_CLOCK_N_INTEGER_COMPARE_VALUE_1_ADDR A:0xa3ff1b4
y.create.l HWIO_WCSS_A_BT_BLUETOOTH_CLOCK_N_FRACTIONAL_COMPARE_VALUE_1_ADDR A:0xa3ff1b8
y.create.l HWIO_WCSS_A_BT_BURST_COEXISTENCE_COMMAND_ADDR A:0xa3ff1bc
y.create.l HWIO_WCSS_A_BT_BURST_COEXISTENCE_STATUS_ADDR A:0xa3ff1c0
y.create.l HWIO_WCSS_A_BT_BURST_PRESLOT_ADDR A:0xa3ff1c4
y.create.l HWIO_WCSS_A_BT_BURST_TX_COMMAND_ADDR A:0xa3ff1c8
y.create.l HWIO_WCSS_A_BT_BURST_TX_HOP_STROBE_ADDR A:0xa3ff1cc
y.create.l HWIO_WCSS_A_BT_BURST_TX_ON_ADDR A:0xa3ff1d0
y.create.l HWIO_WCSS_A_BT_BURST_RX_COMMAND_ADDR A:0xa3ff1d4
y.create.l HWIO_WCSS_A_BT_BURST_RX_HOP_STROBE_ADDR A:0xa3ff1d8
y.create.l HWIO_WCSS_A_BT_BURST_RX_ON_ADDR A:0xa3ff1dc
y.create.l HWIO_WCSS_A_BT_RX_ACCESS_CODE_DETECT_HARD_ALIGN_ADDR A:0xa3ff1e0
y.create.l HWIO_WCSS_A_BT_RX_PACKET_HEADER_HARD_ALIGN_ADDR A:0xa3ff1e4
y.create.l HWIO_WCSS_A_BT_TX_GUARD_SYNC_LENGTH_ADDR A:0xa3ff1e8
y.create.l HWIO_WCSS_A_BT_SOFTWARE_INTERRUPT_LATENCY_ADDR A:0xa3ff1ec
y.create.l HWIO_WCSS_A_BT_RX_DEMODULATOR_DELAY_ADDR A:0xa3ff1f0
y.create.l HWIO_WCSS_A_BT_TX_PACKET_HEADER_HARD_ALIGN_ADDR A:0xa3ff1f4
y.create.l HWIO_WCSS_A_BT_BT_TO_LPASS_AUDIO_ADDR A:0xa3ff1fc
y.create.l HWIO_WCSS_A_BT_LC_RX_AGC_RSSI_OUT_0_ADDR A:0xa3ff200
y.create.l HWIO_WCSS_A_BT_LC_RX_AGC_RSSI_OUT_1_ADDR A:0xa3ff204
y.create.l HWIO_WCSS_A_BT_LC_SIF_CTRL_ADDR A:0xa3ff208
y.create.l HWIO_WCSS_A_BT_MWS_CTRL_ADDR A:0xa3ff320
y.create.l HWIO_WCSS_A_BT_INT_0_LE_BTC_SLOT_BURST_TIMER_ADDR A:0xa3ff348
y.create.l HWIO_WCSS_A_BT_LE_BURST_COEXISTENCE_COMMAND_ADDR A:0xa3ff34c
y.create.l HWIO_WCSS_A_BT_LE_BURST_COEXISTENCE_STATUS_ADDR A:0xa3ff350
y.create.l HWIO_WCSS_A_BT_LE_BURST_PRESLOT_ADDR A:0xa3ff354
y.create.l HWIO_WCSS_A_BT_LE_BURST_TX_COMMAND_ADDR A:0xa3ff358
y.create.l HWIO_WCSS_A_BT_LE_BURST_TX_HOP_STROBE_ADDR A:0xa3ff35c
y.create.l HWIO_WCSS_A_BT_LE_BURST_TX_ON_ADDR A:0xa3ff360
y.create.l HWIO_WCSS_A_BT_LE_BURST_RX_COMMAND_ADDR A:0xa3ff364
y.create.l HWIO_WCSS_A_BT_LE_BURST_RX_HOP_STROBE_ADDR A:0xa3ff368
y.create.l HWIO_WCSS_A_BT_LE_BURST_RX_ON_ADDR A:0xa3ff36c
y.create.l HWIO_WCSS_A_BT_PACKET_REPEAT_NUMBER_ADDR A:0xa3ff370
y.create.l HWIO_WCSS_A_BT_GOOD_CRC_COUNTER_ADDR A:0xa3ff374
y.create.l HWIO_WCSS_A_BT_LE_RX_HARD_ALIGN_ADDR A:0xa3ff378
y.create.l HWIO_WCSS_A_BT_LE_CONTROL_ADDR A:0xa3ff37c
y.create.l HWIO_WCSS_A_BT_LE_HOP_OFFSET_ADDR A:0xa3ff380
y.create.l HWIO_WCSS_A_BT_BLUETOOTH_CLOCK_N_INTEGER_COMPARE_VALUE_2_ADDR A:0xa3ff388
y.create.l HWIO_WCSS_A_BT_BLUETOOTH_CLOCK_N_FRACTIONAL_COMPARE_VALUE_2_ADDR A:0xa3ff38c
y.create.l HWIO_WCSS_A_BT_CRYPTO_TX_PAYLOAD_BUFFER_POINTER_AND_LENGTH_ADDR A:0xa3ff390
y.create.l HWIO_WCSS_A_BT_CRYPTO_KEYN_ADDR A:0xa3ff394
y.create.l HWIO_WCSS_A_BT_CRYPTO_A0_B0_B1_ADDR A:0xa3ff398
y.create.l HWIO_WCSS_A_BT_ERROR_STATUS_REGISTER_ADDR A:0xa3ff39c
y.create.l HWIO_WCSS_A_BT_CLOCK_GATING_ADDR A:0xa3ff3a0
y.create.l HWIO_WCSS_A_BT_GAM_GAS_CONFIG_ADDR A:0xa3ff3a4
y.create.l HWIO_WCSS_A_BT_ESCO_CRYPTO_A0_B0_B1_ADDR A:0xa3ff3a8
y.create.l HWIO_WCSS_A_CRYPTO4_CRYPTO_VERSION_ADDR A:0xa400000
y.create.l HWIO_WCSS_A_CRYPTO4_CRYPTO_DATA_IN_ADDR A:0xa400008
y.create.l HWIO_WCSS_A_CRYPTO4_CRYPTO_DATA_OUT_ADDR A:0xa400010
y.create.l HWIO_WCSS_A_CRYPTO4_CRYPTO_STATUS_ADDR A:0xa400100
y.create.l HWIO_WCSS_A_CRYPTO4_CRYPTO_ENGINES_AVAIL_ADDR A:0xa400104
y.create.l HWIO_WCSS_A_CRYPTO4_CRYPTO_SEG_SIZE_ADDR A:0xa400200
y.create.l HWIO_WCSS_A_CRYPTO4_CRYPTO_GOPROC_ADDR A:0xa400204
y.create.l HWIO_WCSS_A_CRYPTO4_CRYPTO_ENCR_SEG_CFG_ADDR A:0xa400300
y.create.l HWIO_WCSS_A_CRYPTO4_CRYPTO_ENCR_SEG_SIZE_ADDR A:0xa400304
y.create.l HWIO_WCSS_A_CRYPTO4_CRYPTO_ENCR_SEG_START_ADDR A:0xa400308
y.create.l HWIO_WCSS_A_CRYPTO4_CRYPTO_ENCR_KEY0_ADDR A:0xa400310
y.create.l HWIO_WCSS_A_CRYPTO4_CRYPTO_ENCR_KEY1_ADDR A:0xa400314
y.create.l HWIO_WCSS_A_CRYPTO4_CRYPTO_ENCR_KEY2_ADDR A:0xa400318
y.create.l HWIO_WCSS_A_CRYPTO4_CRYPTO_ENCR_KEY3_ADDR A:0xa40031c
y.create.l HWIO_WCSS_A_CRYPTO4_CRYPTO_ENCR_KEY4_ADDR A:0xa400320
y.create.l HWIO_WCSS_A_CRYPTO4_CRYPTO_ENCR_KEY5_ADDR A:0xa400324
y.create.l HWIO_WCSS_A_CRYPTO4_CRYPTO_ENCR_KEY6_ADDR A:0xa400328
y.create.l HWIO_WCSS_A_CRYPTO4_CRYPTO_ENCR_KEY7_ADDR A:0xa40032c
y.create.l HWIO_WCSS_A_CRYPTO4_CRYPTO_ENCR_XTS_KEY0_ADDR A:0xa400330
y.create.l HWIO_WCSS_A_CRYPTO4_CRYPTO_ENCR_XTS_KEY1_ADDR A:0xa400334
y.create.l HWIO_WCSS_A_CRYPTO4_CRYPTO_ENCR_XTS_KEY2_ADDR A:0xa400338
y.create.l HWIO_WCSS_A_CRYPTO4_CRYPTO_ENCR_XTS_KEY3_ADDR A:0xa40033c
y.create.l HWIO_WCSS_A_CRYPTO4_CRYPTO_ENCR_XTS_KEY4_ADDR A:0xa400340
y.create.l HWIO_WCSS_A_CRYPTO4_CRYPTO_ENCR_XTS_KEY5_ADDR A:0xa400344
y.create.l HWIO_WCSS_A_CRYPTO4_CRYPTO_ENCR_XTS_KEY6_ADDR A:0xa400348
y.create.l HWIO_WCSS_A_CRYPTO4_CRYPTO_ENCR_XTS_KEY7_ADDR A:0xa40034c
y.create.l HWIO_WCSS_A_CRYPTO4_CRYPTO_ENCR_CNTR0_IV0_ADDR A:0xa400350
y.create.l HWIO_WCSS_A_CRYPTO4_CRYPTO_ENCR_CNTR1_IV1_ADDR A:0xa400354
y.create.l HWIO_WCSS_A_CRYPTO4_CRYPTO_ENCR_CNTR2_IV2_ADDR A:0xa400358
y.create.l HWIO_WCSS_A_CRYPTO4_CRYPTO_ENCR_CNTR3_IV3_ADDR A:0xa40035c
y.create.l HWIO_WCSS_A_CRYPTO4_CRYPTO_ENCR_CNTR_MASK_ADDR A:0xa400360
y.create.l HWIO_WCSS_A_CRYPTO4_CRYPTO_ENCR_XTS_DU_SIZE_ADDR A:0xa400364
y.create.l HWIO_WCSS_A_CRYPTO4_CRYPTO_AUTH_SEG_CFG_ADDR A:0xa400400
y.create.l HWIO_WCSS_A_CRYPTO4_CRYPTO_AUTH_SEG_SIZE_ADDR A:0xa400404
y.create.l HWIO_WCSS_A_CRYPTO4_CRYPTO_AUTH_SEG_START_ADDR A:0xa400408
y.create.l HWIO_WCSS_A_CRYPTO4_CRYPTO_AUTH_KEY0_ADDR A:0xa400410
y.create.l HWIO_WCSS_A_CRYPTO4_CRYPTO_AUTH_KEY1_ADDR A:0xa400414
y.create.l HWIO_WCSS_A_CRYPTO4_CRYPTO_AUTH_KEY2_ADDR A:0xa400418
y.create.l HWIO_WCSS_A_CRYPTO4_CRYPTO_AUTH_KEY3_ADDR A:0xa40041c
y.create.l HWIO_WCSS_A_CRYPTO4_CRYPTO_AUTH_KEY4_ADDR A:0xa400420
y.create.l HWIO_WCSS_A_CRYPTO4_CRYPTO_AUTH_KEY5_ADDR A:0xa400424
y.create.l HWIO_WCSS_A_CRYPTO4_CRYPTO_AUTH_KEY6_ADDR A:0xa400428
y.create.l HWIO_WCSS_A_CRYPTO4_CRYPTO_AUTH_KEY7_ADDR A:0xa40042c
y.create.l HWIO_WCSS_A_CRYPTO4_CRYPTO_AUTH_KEY8_ADDR A:0xa400430
y.create.l HWIO_WCSS_A_CRYPTO4_CRYPTO_AUTH_KEY9_ADDR A:0xa400434
y.create.l HWIO_WCSS_A_CRYPTO4_CRYPTO_AUTH_IV0_ADDR A:0xa400450
y.create.l HWIO_WCSS_A_CRYPTO4_CRYPTO_AUTH_IV1_ADDR A:0xa400454
y.create.l HWIO_WCSS_A_CRYPTO4_CRYPTO_AUTH_IV2_ADDR A:0xa400458
y.create.l HWIO_WCSS_A_CRYPTO4_CRYPTO_AUTH_IV3_ADDR A:0xa40045c
y.create.l HWIO_WCSS_A_CRYPTO4_CRYPTO_AUTH_IV4_ADDR A:0xa400460
y.create.l HWIO_WCSS_A_CRYPTO4_CRYPTO_AUTH_IV5_ADDR A:0xa400464
y.create.l HWIO_WCSS_A_CRYPTO4_CRYPTO_AUTH_IV6_ADDR A:0xa400468
y.create.l HWIO_WCSS_A_CRYPTO4_CRYPTO_AUTH_IV7_ADDR A:0xa40046c
y.create.l HWIO_WCSS_A_CRYPTO4_CRYPTO_AUTH_IV8_ADDR A:0xa400470
y.create.l HWIO_WCSS_A_CRYPTO4_CRYPTO_AUTH_IV9_ADDR A:0xa400474
y.create.l HWIO_WCSS_A_CRYPTO4_CRYPTO_AUTH_INFO_NONCE0_ADDR A:0xa400490
y.create.l HWIO_WCSS_A_CRYPTO4_CRYPTO_AUTH_INFO_NONCE1_ADDR A:0xa400494
y.create.l HWIO_WCSS_A_CRYPTO4_CRYPTO_AUTH_INFO_NONCE2_ADDR A:0xa400498
y.create.l HWIO_WCSS_A_CRYPTO4_CRYPTO_AUTH_INFO_NONCE3_ADDR A:0xa40049c
y.create.l HWIO_WCSS_A_CRYPTO4_CRYPTO_AUTH_BYTECNT0_ADDR A:0xa4004a0
y.create.l HWIO_WCSS_A_CRYPTO4_CRYPTO_AUTH_BYTECNT1_ADDR A:0xa4004a4
y.create.l HWIO_WCSS_A_CRYPTO4_CRYPTO_AUTH_BYTECNT2_ADDR A:0xa4004a8
y.create.l HWIO_WCSS_A_CRYPTO4_CRYPTO_AUTH_BYTECNT3_ADDR A:0xa4004ac
y.create.l HWIO_WCSS_A_CRYPTO4_CRYPTO_AUTH_EXP_MAC0_ADDR A:0xa4004b0
y.create.l HWIO_WCSS_A_CRYPTO4_CRYPTO_AUTH_EXP_MAC1_ADDR A:0xa4004b4
y.create.l HWIO_WCSS_A_CRYPTO4_CRYPTO_AUTH_EXP_MAC2_ADDR A:0xa4004b8
y.create.l HWIO_WCSS_A_CRYPTO4_CRYPTO_AUTH_EXP_MAC3_ADDR A:0xa4004bc
y.create.l HWIO_WCSS_A_CRYPTO4_CRYPTO_AUTH_EXP_MAC4_ADDR A:0xa4004c0
y.create.l HWIO_WCSS_A_CRYPTO4_CRYPTO_AUTH_EXP_MAC5_ADDR A:0xa4004c4
y.create.l HWIO_WCSS_A_CRYPTO4_CRYPTO_AUTH_EXP_MAC6_ADDR A:0xa4004c8
y.create.l HWIO_WCSS_A_CRYPTO4_CRYPTO_AUTH_EXP_MAC7_ADDR A:0xa4004cc
y.create.l HWIO_WCSS_A_CRYPTO4_CRYPTO_CONFIG_ADDR A:0xa400500
y.create.l HWIO_WCSS_A_CRYPTO4_CRYPTO_SACR_ADDR A:0xa400504
y.create.l HWIO_WCSS_A_CRYPTO4_CRYPTO_DEBUG_ADDR A:0xa400508
y.create.l HWIO_WCSS_A_CRYPTO4_CRYPTO_DATA_SHADOW0_ADDR A:0xa408000
y.create.l HWIO_WCSS_A_CRYPTO4_CRYPTO_DATA_SHADOW8191_ADDR A:0xa40fffc
y.create.l HWIO_WCSS_A_QTA_BT_INTR_ADDR A:0xa4c0000
y.create.l HWIO_WCSS_A_QTA_BT_INTR_EN_ADDR A:0xa4c0004
y.create.l HWIO_WCSS_A_QTA_BT_UART_CTRL_ADDR A:0xa4c0008
y.create.l HWIO_WCSS_A_QTA_BT_HW_CTRL_ADDR A:0xa4c000c
y.create.l HWIO_WCSS_A_QTA_BT_HW_TX_BUFFER_MODIFY_ADDR A:0xa4c0010
y.create.l HWIO_WCSS_A_QTA_BT_SW_CTRL_ADDR A:0xa4c0014
y.create.l HWIO_WCSS_A_QTA_BT_SW_TX_FIFO_IN_ADDR A:0xa4c0018
y.create.l HWIO_WCSS_A_QTA_BT_SW_RX_FIFO_OUT_ADDR A:0xa4c001c
y.create.l HWIO_WCSS_A_QTA_BT_TESTBUS_ADDR A:0xa4c0020
y.create.l HWIO_WCSS_A_BT_SSBI2_CFG_SSBI2_PVC_FIFO_ADDR A:0xa4afffc
y.create.l HWIO_WCSS_A_SSBI2_CFG_SSBI2_CTL_ADDR A:0xa4a0000
y.create.l HWIO_WCSS_A_SSBI2_CFG_SSBI2_INT_ENABLE_ADDR A:0xa4a0004
y.create.l HWIO_WCSS_A_SSBI2_CFG_SSBI2_PRIORITIES_ADDR A:0xa4a0008
y.create.l HWIO_WCSS_A_SSBI2_CFG_SSBI2_BANKS_2_3_CTL_ADDR A:0xa4a000c
y.create.l HWIO_WCSS_A_SSBI2_CFG_SSBI2_ILLEGAL_STATUS_ADDR A:0xa4a0010
y.create.l HWIO_WCSS_A_SSBI2_CFG_SSBI2_TEST_BUS_CTL_ADDR A:0xa4a0014
y.create.l HWIO_WCSS_A_SSBI2_CFG_SSBI2_VIT0_ADDR A:0xa4a0020
y.create.l HWIO_WCSS_A_SSBI2_CFG_SSBI2_VIT1_ADDR A:0xa4a0024
y.create.l HWIO_WCSS_A_SSBI2_CFG_SSBI2_VIT2_ADDR A:0xa4a0028
y.create.l HWIO_WCSS_A_SSBI2_CFG_SSBI2_VIT3_ADDR A:0xa4a002c
y.create.l HWIO_WCSS_A_SSBI2_CFG_SSBI2_VIT4_ADDR A:0xa4a0030
y.create.l HWIO_WCSS_A_SSBI2_CFG_SSBI2_VIT5_ADDR A:0xa4a0034
y.create.l HWIO_WCSS_A_SSBI2_CFG_SSBI2_VIT6_ADDR A:0xa4a0038
y.create.l HWIO_WCSS_A_SSBI2_CFG_SSBI2_PVC_CTL_ADDR A:0xa4a00a0
y.create.l HWIO_WCSS_A_SSBI2_CFG_SSBI2_PVC_TABLE0_ADDR A:0xa4a00a4
y.create.l HWIO_WCSS_A_SSBI2_CFG_SSBI2_PVC_TABLE1_ADDR A:0xa4a00a8
y.create.l HWIO_WCSS_A_SSBI2_CFG_SSBI2_PVC_TABLE2_ADDR A:0xa4a00ac
y.create.l HWIO_WCSS_A_SSBI2_CFG_SSBI2_PVC_TABLE3_ADDR A:0xa4a00b0
y.create.l HWIO_WCSS_A_SSBI2_CFG_SSBI2_PVC_TABLE4_ADDR A:0xa4a00b4
y.create.l HWIO_WCSS_A_SSBI2_CFG_SSBI2_PVC_TABLE5_ADDR A:0xa4a00b8
y.create.l HWIO_WCSS_A_SSBI2_CFG_SSBI2_PVC_TABLE6_ADDR A:0xa4a00bc
y.create.l HWIO_WCSS_A_SSBI2_CFG_SSBI2_PVC_TABLE7_ADDR A:0xa4a00c0
y.create.l HWIO_WCSS_A_SSBI2_CFG_SSBI2_PVC_TABLE8_ADDR A:0xa4a00c4
y.create.l HWIO_WCSS_A_SSBI2_CFG_SSBI2_PVC_TABLE9_ADDR A:0xa4a00c8
y.create.l HWIO_WCSS_A_SSBI2_CMD_SSBI2_CMD_ADDR A:0xa480000
y.create.l HWIO_WCSS_A_SSBI2_CMD_SSBI2_RD_STATUS_ADDR A:0xa480004
y.create.l HWIO_WCSS_A_XPU_XPU_SCR_ADDR A:0xa21f000
y.create.l HWIO_WCSS_A_XPU_XPU_SWDR_ADDR A:0xa21f004
y.create.l HWIO_WCSS_A_XPU_XPU_SEAR0_ADDR A:0xa21f040
y.create.l HWIO_WCSS_A_XPU_XPU_SESR_ADDR A:0xa21f048
y.create.l HWIO_WCSS_A_XPU_XPU_SESRRESTORE_ADDR A:0xa21f04c
y.create.l HWIO_WCSS_A_XPU_XPU_SESYNR0_ADDR A:0xa21f050
y.create.l HWIO_WCSS_A_XPU_XPU_SESYNR1_ADDR A:0xa21f054
y.create.l HWIO_WCSS_A_XPU_XPU_SESYNR2_ADDR A:0xa21f058
y.create.l HWIO_WCSS_A_XPU_XPU_MCR_ADDR A:0xa21f100
y.create.l HWIO_WCSS_A_XPU_XPU_MEAR0_ADDR A:0xa21f140
y.create.l HWIO_WCSS_A_XPU_XPU_MESR_ADDR A:0xa21f148
y.create.l HWIO_WCSS_A_XPU_XPU_MESRRESTORE_ADDR A:0xa21f14c
y.create.l HWIO_WCSS_A_XPU_XPU_MESYNR0_ADDR A:0xa21f150
y.create.l HWIO_WCSS_A_XPU_XPU_MESYNR1_ADDR A:0xa21f154
y.create.l HWIO_WCSS_A_XPU_XPU_MESYNR2_ADDR A:0xa21f158
y.create.l HWIO_WCSS_A_XPU_XPU_CR_ADDR A:0xa21f080
y.create.l HWIO_WCSS_A_XPU_XPU_RPU_ACR0_ADDR A:0xa21f0a0
y.create.l HWIO_WCSS_A_XPU_XPU_EAR0_ADDR A:0xa21f0c0
y.create.l HWIO_WCSS_A_XPU_XPU_ESR_ADDR A:0xa21f0c8
y.create.l HWIO_WCSS_A_XPU_XPU_ESRRESTORE_ADDR A:0xa21f0cc
y.create.l HWIO_WCSS_A_XPU_XPU_ESYNR0_ADDR A:0xa21f0d0
y.create.l HWIO_WCSS_A_XPU_XPU_ESYNR1_ADDR A:0xa21f0d4
y.create.l HWIO_WCSS_A_XPU_XPU_ESYNR2_ADDR A:0xa21f0d8
y.create.l HWIO_WCSS_A_XPU_XPU_IDR0_ADDR A:0xa21f074
y.create.l HWIO_WCSS_A_XPU_XPU_IDR1_ADDR A:0xa21f078
y.create.l HWIO_WCSS_A_XPU_XPU_REV_ADDR A:0xa21f07c
y.create.l HWIO_WCSS_A_XPU_XPU_RG0_RACR0_ADDR A:0xa21f200
y.create.l HWIO_WCSS_A_XPU_XPU_RG1_RACR0_ADDR A:0xa21f280
y.create.l HWIO_WCSS_A_XPU_XPU_RG0_WACR0_ADDR A:0xa21f220
y.create.l HWIO_WCSS_A_XPU_XPU_RG1_WACR0_ADDR A:0xa21f2a0
y.create.l HWIO_WCSS_A_XPU_XPU_RG0_SCR_ADDR A:0xa21f250
y.create.l HWIO_WCSS_A_XPU_XPU_RG1_SCR_ADDR A:0xa21f2d0
y.create.l HWIO_WCSS_A_XPU_XPU_RG0_MCR_ADDR A:0xa21f254
y.create.l HWIO_WCSS_A_XPU_XPU_RG1_MCR_ADDR A:0xa21f2d4
y.create.l HWIO_WCSS_A_PMU_TOP_BCR_ADDR A:0xa21b000
y.create.l HWIO_WCSS_A_PMU_TOP_AHB_CBCR_ADDR A:0xa21b008
y.create.l HWIO_WCSS_A_PMU_BUS_TIMEOUT_CBCR_ADDR A:0xa21b00c
y.create.l HWIO_WCSS_A_PMU_TOP_SLP_CBCR_ADDR A:0xa21b010
y.create.l HWIO_WCSS_A_PMU_TOP_XO_CBCR_ADDR A:0xa21b014
y.create.l HWIO_WCSS_A_PMU_AXI_M_CBCR_ADDR A:0xa21b018
y.create.l HWIO_WCSS_A_PMU_COMMON_SS_BCR_ADDR A:0xa21b020
y.create.l HWIO_WCSS_A_PMU_COMMON_GDSCR_ADDR A:0xa21b024
y.create.l HWIO_WCSS_A_PMU_COMMON_PHY_DBG_CBCR_ADDR A:0xa21b028
y.create.l HWIO_WCSS_A_PMU_COMMON_TRC_CBCR_ADDR A:0xa21b02c
y.create.l HWIO_WCSS_A_PMU_COMMON_CPU_CBCR_ADDR A:0xa21b030
y.create.l HWIO_WCSS_A_PMU_COMMON_AHB_CBCR_ADDR A:0xa21b034
y.create.l HWIO_WCSS_A_PMU_COMMON_BT_32M_CBCR_ADDR A:0xa21b038
y.create.l HWIO_WCSS_A_PMU_COMMON_BT_FM_19M_CBCR_ADDR A:0xa21b03c
y.create.l HWIO_WCSS_A_PMU_COMMON_SLP_CBCR_ADDR A:0xa21b040
y.create.l HWIO_WCSS_A_PMU_COMMON_XO_CBCR_ADDR A:0xa21b044
y.create.l HWIO_WCSS_A_PMU_WLAN_BCR_ADDR A:0xa21b050
y.create.l HWIO_WCSS_A_PMU_WLAN_GDSCR_ADDR A:0xa21b054
y.create.l HWIO_WCSS_A_PMU_WLAN_RFA_CAL_CBCR_ADDR A:0xa21b058
y.create.l HWIO_WCSS_A_PMU_WLAN_PHY_MAIN1_FAST_CBCR_ADDR A:0xa21b05c
y.create.l HWIO_WCSS_A_PMU_WLAN_PHY_MAIN1_TX_CBCR_ADDR A:0xa21b060
y.create.l HWIO_WCSS_A_PMU_WLAN_PHY_MAIN1_RX_CBCR_ADDR A:0xa21b064
y.create.l HWIO_WCSS_A_PMU_WLAN_PHY_MAIN2_CBCR_ADDR A:0xa21b068
y.create.l HWIO_WCSS_A_PMU_WLAN_PHY_DBG_CBCR_ADDR A:0xa21b06c
y.create.l HWIO_WCSS_A_PMU_WLAN_PHY_DAC_CBCR_ADDR A:0xa21b070
y.create.l HWIO_WCSS_A_PMU_WLAN_AHB_CBCR_ADDR A:0xa21b074
y.create.l HWIO_WCSS_A_PMU_WLAN_PHY_ADC_CBCR_ADDR A:0xa21b078
y.create.l HWIO_WCSS_A_PMU_WLAN_RFIF_CBCR_ADDR A:0xa21b07c
y.create.l HWIO_WCSS_A_PMU_ADC_240M_CBCR_ADDR A:0xa21b080
y.create.l HWIO_WCSS_A_PMU_DAC_SM_CBCR_ADDR A:0xa21b084
y.create.l HWIO_WCSS_A_PMU_PHY_FAST_CMD_RCGR_ADDR A:0xa21b0a0
y.create.l HWIO_WCSS_A_PMU_PHY_FAST_CFG_RCGR_ADDR A:0xa21b0a4
y.create.l HWIO_WCSS_A_PMU_PHY_CMD_RCGR_ADDR A:0xa21b0c0
y.create.l HWIO_WCSS_A_PMU_PHY_CFG_RCGR_ADDR A:0xa21b0c4
y.create.l HWIO_WCSS_A_PMU_PHY_M_ADDR A:0xa21b0c8
y.create.l HWIO_WCSS_A_PMU_PHY_N_ADDR A:0xa21b0cc
y.create.l HWIO_WCSS_A_PMU_PHY_D_ADDR A:0xa21b0d0
y.create.l HWIO_WCSS_A_PMU_ADCDAC_CMD_RCGR_ADDR A:0xa21b0e0
y.create.l HWIO_WCSS_A_PMU_ADCDAC_CFG_RCGR_ADDR A:0xa21b0e4
y.create.l HWIO_WCSS_A_PMU_ADCDAC_M_ADDR A:0xa21b0e8
y.create.l HWIO_WCSS_A_PMU_ADCDAC_N_ADDR A:0xa21b0ec
y.create.l HWIO_WCSS_A_PMU_ADCDAC_D_ADDR A:0xa21b0f0
y.create.l HWIO_WCSS_A_PMU_RFIF_CMD_RCGR_ADDR A:0xa21b100
y.create.l HWIO_WCSS_A_PMU_RFIF_CFG_RCGR_ADDR A:0xa21b104
y.create.l HWIO_WCSS_A_PMU_RFIF_M_ADDR A:0xa21b108
y.create.l HWIO_WCSS_A_PMU_RFIF_N_ADDR A:0xa21b10c
y.create.l HWIO_WCSS_A_PMU_RFIF_D_ADDR A:0xa21b110
y.create.l HWIO_WCSS_A_PMU_CPU_AHB_CMD_RCGR_ADDR A:0xa21b120
y.create.l HWIO_WCSS_A_PMU_CPU_AHB_CFG_RCGR_ADDR A:0xa21b124
y.create.l HWIO_WCSS_A_PMU_CPU_AHB_MISC_ADDR A:0xa21b134
y.create.l HWIO_WCSS_A_PMU_BT_32M_CMD_RCGR_ADDR A:0xa21b140
y.create.l HWIO_WCSS_A_PMU_BT_32M_CFG_RCGR_ADDR A:0xa21b144
y.create.l HWIO_WCSS_A_PMU_BT_FM_19M_CMD_RCGR_ADDR A:0xa21b160
y.create.l HWIO_WCSS_A_PMU_BT_FM_19M_CFG_RCGR_ADDR A:0xa21b164
y.create.l HWIO_WCSS_A_PMU_SLP_CMD_RCGR_ADDR A:0xa21b180
y.create.l HWIO_WCSS_A_PMU_SLP_CFG_RCGR_ADDR A:0xa21b184
y.create.l HWIO_WCSS_A_PMU_XO_CMD_RCGR_ADDR A:0xa21b1a0
y.create.l HWIO_WCSS_A_PMU_XO_CFG_RCGR_ADDR A:0xa21b1a4
y.create.l HWIO_WCSS_A_PMU_PLL_MODE_ADDR A:0xa21b1c0
y.create.l HWIO_WCSS_A_PMU_PLL_L_VAL_ADDR A:0xa21b1c4
y.create.l HWIO_WCSS_A_PMU_PLL_M_VAL_ADDR A:0xa21b1c8
y.create.l HWIO_WCSS_A_PMU_PLL_N_VAL_ADDR A:0xa21b1cc
y.create.l HWIO_WCSS_A_PMU_PLL_USER_CTL_ADDR A:0xa21b1d0
y.create.l HWIO_WCSS_A_PMU_PLL_CONFIG_CTL_ADDR A:0xa21b1d4
y.create.l HWIO_WCSS_A_PMU_PLL_TEST_CTL_ADDR A:0xa21b1d8
y.create.l HWIO_WCSS_A_PMU_PLL_STATUS_ADDR A:0xa21b1dc
y.create.l HWIO_WCSS_A_PMU_WCSS_DEBUG_CLK_CTL_ADDR A:0xa21b1e0
y.create.l HWIO_WCSS_A_PMU_HW_VERSION_ADDR A:0xa21c000
y.create.l HWIO_WCSS_A_PMU_CFG_ADDR A:0xa21c004
y.create.l HWIO_WCSS_A_PMU_OVRD_EN_ADDR A:0xa21c008
y.create.l HWIO_WCSS_A_PMU_OVRD_VAL_ADDR A:0xa21c00c
y.create.l HWIO_WCSS_A_PMU_SLP_TMR_CTL_ADDR A:0xa21c010
y.create.l HWIO_WCSS_A_PMU_SLP_TMR_STS_ADDR A:0xa21c014
y.create.l HWIO_WCSS_A_PMU_SLP_TMR_VAL_WR_ADDR A:0xa21c018
y.create.l HWIO_WCSS_A_PMU_SLP_TMR_VAL_ADDR A:0xa21c01c
y.create.l HWIO_WCSS_A_PMU_WLAN_SLP_TMR_CTL_ADDR A:0xa21c020
y.create.l HWIO_WCSS_A_PMU_WLAN_SLP_TMR_STS_ADDR A:0xa21c024
y.create.l HWIO_WCSS_A_PMU_WLAN_SLP_TMR_EXP_ADDR A:0xa21c028
y.create.l HWIO_WCSS_A_PMU_BT_SLP_TMR_CTL_ADDR A:0xa21c02c
y.create.l HWIO_WCSS_A_PMU_BT_SLP_TMR_STS_ADDR A:0xa21c030
y.create.l HWIO_WCSS_A_PMU_BT_SLP_TMR_EXP_ADDR A:0xa21c034
y.create.l HWIO_WCSS_A_PMU_PWR_CNTL_ADCDAC_ADDR A:0xa21c038
y.create.l HWIO_WCSS_A_PMU_WMAC_CSR_ADDR A:0xa21c03c
y.create.l HWIO_WCSS_A_PMU_COMMON_CSR_ADDR A:0xa21c040
y.create.l HWIO_WCSS_A_PMU_ROOT_CLK_ENABLE_ADDR A:0xa21c044
y.create.l HWIO_WCSS_A_PMU_CLKGATE_DISABLE_ADDR A:0xa21c048
y.create.l HWIO_WCSS_A_PMU_SOFT_RESET_ADDR A:0xa21c04c
y.create.l HWIO_WCSS_A_PMU_PMU_TESTBUS_CTL_ADDR A:0xa21c050
y.create.l HWIO_WCSS_A_PMU_PMU_TESTBUS_STS_ADDR A:0xa21c054
y.create.l HWIO_WCSS_A_PMU_TESTBUS_CTL_ADDR A:0xa21c058
y.create.l HWIO_WCSS_A_PMU_TESTBUS_STS_ADDR A:0xa21c05c
y.create.l HWIO_WCSS_A_PMU_WLAN_POWER_MEASURE_ADDR A:0xa21c060
y.create.l HWIO_WCSS_A_PMU_WCSS_IPC_ADDR A:0xa21c064
y.create.l HWIO_WCSS_A_PMU_WDOG_CTL_ADDR A:0xa21c068
y.create.l HWIO_WCSS_A_PMU_WDOG_STS_ADDR A:0xa21c06c
y.create.l HWIO_WCSS_A_PMU_WDOG_COUNT_ADDR A:0xa21c070
y.create.l HWIO_WCSS_A_PMU_WDOG_BITE_SECURE_ADDR A:0xa21c074
y.create.l HWIO_WCSS_A_PMU_WDOG_BARK_TIME_ADDR A:0xa21c078
y.create.l HWIO_WCSS_A_PMU_WDOG_BITE_TIME_ADDR A:0xa21c07c
y.create.l HWIO_WCSS_A_PMU_WDOG_TEST_ADDR A:0xa21c080
y.create.l HWIO_WCSS_A_PMU_SPARE_IN_ADDR A:0xa21c084
y.create.l HWIO_WCSS_A_PMU_SPARE_OUT_ADDR A:0xa21c088
y.create.l HWIO_WCSS_A_PMU_SPARE_OUT_SPARE_OUT_BMSK 0xfffffffe
y.create.l HWIO_WCSS_A_PMU_SPARE_OUT_SPARE_OUT_SHFT 0x1
y.create.l HWIO_WCSS_A_PMU_SPARE_OUT_SW_DEBUG_EN_BMSK 0x1
y.create.l HWIO_WCSS_A_PMU_SPARE_OUT_SW_DEBUG_EN_SHFT 0x0
y.create.l HWIO_WCSS_A_PMU_AOA2AB_CTL_ADDR A:0xa21c08c
y.create.l HWIO_WCSS_A_PMU_AOA2AB_WRAP_ADDR_ADDR A:0xa21c090
y.create.l HWIO_WCSS_A_PMU_AOA2AB_AHB_ERR_ADDR_ADDR A:0xa21c094
y.create.l HWIO_WCSS_A_PMU_SPM_DBG_ADDR A:0xa21c098
y.create.l HWIO_WCSS_A_PMU_DAC_CAL_CTL_ADDR A:0xa21c09c
y.create.l HWIO_WCSS_A_PMU_BT_SW_EVENT_ADDR A:0xa21c0a0
y.create.l HWIO_WCSS_A_PMU_IRIS_XO_SETTLE_TIME_ADDR A:0xa21c124
y.create.l HWIO_WCSS_A_PMU_IRIS_XO_SETTLE_TIMER_CSR_ADDR A:0xa21c128
y.create.l HWIO_WCSS_A_PMU_IRIS_XO_TIMER_ADDR A:0xa21c12c
y.create.l HWIO_WCSS_A_PMU_COMMON_SS_MEM_SLP_CTL_ADDR A:0xa21c130
y.create.l HWIO_WCSS_A_PMU_IRIS_REG_READ_ADDR A:0xa21c134
y.create.l HWIO_WCSS_A_PMU_WLAN_COEX_CTL_ADDR A:0xa21c138
y.create.l HWIO_WCSS_A_PMU_CCPU_CTL_ADDR A:0xa21d000
y.create.l HWIO_WCSS_A_PMU_CCPU_BOOT_REMAP_ADDR_ADDR A:0xa21d004
y.create.l HWIO_WCSS_A_PMU_CMEM_ACCESS_CTL_ADDR A:0xa21d008
Y.CREATE.L HWIO_WCSS_A_PMU_CCPU_BOOT_REMAP_ADDR_CCPU_BOOT_REMAP_ADDR_BMSK 0xffff
Y.CREATE.L HWIO_WCSS_A_PMU_CCPU_BOOT_REMAP_ADDR_CCPU_BOOT_REMAP_ADDR_SHFT 0x0
y.create.l HWIO_WCSS_A_AOAHB_AOAHB_AOWBR_PL_ADDR A:0xa21a000
y.create.l HWIO_WCSS_A_AOAHB_AOAHB_AOA2AB_PL_ADDR A:0xa21a004
y.create.l HWIO_WCSS_A_AOAHB_AOAHB_DFLT_MST_ADDR A:0xa21a048
y.create.l HWIO_WCSS_A_AOAHB_AOAHB_VERSION_ADDR A:0xa21a090
y.create.l HWIO_WCSS_A_SAW2_SAW2_SECURE_ADDR A:0xa219000
y.create.l HWIO_WCSS_A_SAW2_SAW2_ID_ADDR A:0xa219004
y.create.l HWIO_WCSS_A_SAW2_SAW2_CFG_ADDR A:0xa219008
y.create.l HWIO_WCSS_A_SAW2_SAW2_SPM_STS_ADDR A:0xa21900c
y.create.l HWIO_WCSS_A_SAW2_SAW2_AVS_STS_ADDR A:0xa219010
y.create.l HWIO_WCSS_A_SAW2_SAW2_PMIC_STS_ADDR A:0xa219014
y.create.l HWIO_WCSS_A_SAW2_SAW2_RST_ADDR A:0xa219018
y.create.l HWIO_WCSS_A_SAW2_SAW2_SPM_CTL_ADDR A:0xa219030
y.create.l HWIO_WCSS_A_SAW2_SAW2_SPM_DLY_ADDR A:0xa219034
y.create.l HWIO_WCSS_A_SAW2_SAW2_SPM_STS2_ADDR A:0xa219038
y.create.l HWIO_WCSS_A_SAW2_SAW2_SPM_SLP_SEQ_ENTRY_0_ADDR A:0xa219400
y.create.l HWIO_WCSS_A_SAW2_SAW2_SPM_SLP_SEQ_ENTRY_1_ADDR A:0xa219404
y.create.l HWIO_WCSS_A_SAW2_SAW2_SPM_SLP_SEQ_ENTRY_2_ADDR A:0xa219408
y.create.l HWIO_WCSS_A_SAW2_SAW2_SPM_SLP_SEQ_ENTRY_3_ADDR A:0xa21940c
y.create.l HWIO_WCSS_A_SAW2_SAW2_SPM_SLP_SEQ_ENTRY_4_ADDR A:0xa219410
y.create.l HWIO_WCSS_A_SAW2_SAW2_SPM_SLP_SEQ_ENTRY_5_ADDR A:0xa219414
y.create.l HWIO_WCSS_A_SAW2_SAW2_SPM_SLP_SEQ_ENTRY_6_ADDR A:0xa219418
y.create.l HWIO_WCSS_A_SAW2_SAW2_SPM_SLP_SEQ_ENTRY_7_ADDR A:0xa21941c
y.create.l HWIO_WCSS_A_SAW2_SAW2_SPM_SLP_SEQ_ENTRY_8_ADDR A:0xa219420
y.create.l HWIO_WCSS_A_SAW2_SAW2_SPM_SLP_SEQ_ENTRY_9_ADDR A:0xa219424
y.create.l HWIO_WCSS_A_SAW2_SAW2_VERSION_ADDR A:0xa219fd0
y.create.l HWIO_WCSS_A_QTMR_AC_QTMR_AC_CNTFRQ_ADDR A:0xa211000
y.create.l HWIO_WCSS_A_QTMR_AC_QTMR_AC_CNTSR_ADDR A:0xa211004
y.create.l HWIO_WCSS_A_QTMR_AC_QTMR_AC_CNTTID_ADDR A:0xa211008
y.create.l HWIO_WCSS_A_QTMR_AC_QTMR_AC_CNTACR_0_ADDR A:0xa211040
y.create.l HWIO_WCSS_A_QTMR_AC_QTMR_AC_CNTACR_1_ADDR A:0xa211044
y.create.l HWIO_WCSS_A_QTMR_AC_QTMR_AC_CNTACR_2_ADDR A:0xa211048
y.create.l HWIO_WCSS_A_QTMR_AC_QTMR_AC_CNTACR_3_ADDR A:0xa21104c
y.create.l HWIO_WCSS_A_QTMR_AC_QTMR_AC_CNTACR_4_ADDR A:0xa211050
y.create.l HWIO_WCSS_A_QTMR_AC_QTMR_AC_CNTVOFF_LO_0_ADDR A:0xa211080
y.create.l HWIO_WCSS_A_QTMR_AC_QTMR_AC_CNTVOFF_LO_1_ADDR A:0xa211088
y.create.l HWIO_WCSS_A_QTMR_AC_QTMR_AC_CNTVOFF_LO_2_ADDR A:0xa211090
y.create.l HWIO_WCSS_A_QTMR_AC_QTMR_AC_CNTVOFF_LO_3_ADDR A:0xa211098
y.create.l HWIO_WCSS_A_QTMR_AC_QTMR_AC_CNTVOFF_LO_4_ADDR A:0xa2110a0
y.create.l HWIO_WCSS_A_QTMR_AC_QTMR_AC_CNTVOFF_HI_0_ADDR A:0xa211084
y.create.l HWIO_WCSS_A_QTMR_AC_QTMR_AC_CNTVOFF_HI_1_ADDR A:0xa21108c
y.create.l HWIO_WCSS_A_QTMR_AC_QTMR_AC_CNTVOFF_HI_2_ADDR A:0xa211094
y.create.l HWIO_WCSS_A_QTMR_AC_QTMR_AC_CNTVOFF_HI_3_ADDR A:0xa21109c
y.create.l HWIO_WCSS_A_QTMR_AC_QTMR_AC_CNTVOFF_HI_4_ADDR A:0xa2110a4
y.create.l HWIO_WCSS_A_QTMR_AC_QTMR_AC_CFG_ADDR A:0xa211fc0
y.create.l HWIO_WCSS_A_QTMR_AC_QTMR_AC_VERSION_ADDR A:0xa211fd0
y.create.l HWIO_WCSS_A_QTMR_V1_T0_QTMR_V1_CNTPCT_LO_ADDR A:0xa212000
y.create.l HWIO_WCSS_A_QTMR_V1_T0_QTMR_V1_CNTPCT_HI_ADDR A:0xa212004
y.create.l HWIO_WCSS_A_QTMR_V1_T0_QTMR_V1_CNTVCT_LO_ADDR A:0xa212008
y.create.l HWIO_WCSS_A_QTMR_V1_T0_QTMR_V1_CNTVCT_HI_ADDR A:0xa21200c
y.create.l HWIO_WCSS_A_QTMR_V1_T0_QTMR_V1_CNTFRQ_ADDR A:0xa212010
y.create.l HWIO_WCSS_A_QTMR_V1_T0_QTMR_V1_CNTPL0ACR_ADDR A:0xa212014
y.create.l HWIO_WCSS_A_QTMR_V1_T0_QTMR_V1_CNTVOFF_LO_ADDR A:0xa212018
y.create.l HWIO_WCSS_A_QTMR_V1_T0_QTMR_V1_CNTVOFF_HI_ADDR A:0xa21201c
y.create.l HWIO_WCSS_A_QTMR_V1_T0_QTMR_V1_CNTP_CVAL_LO_ADDR A:0xa212020
y.create.l HWIO_WCSS_A_QTMR_V1_T0_QTMR_V1_CNTP_CVAL_HI_ADDR A:0xa212024
y.create.l HWIO_WCSS_A_QTMR_V1_T0_QTMR_V1_CNTP_TVAL_ADDR A:0xa212028
y.create.l HWIO_WCSS_A_QTMR_V1_T0_QTMR_V1_CNTP_CTL_ADDR A:0xa21202c
y.create.l HWIO_WCSS_A_QTMR_V1_T0_QTMR_V1_CNTV_CVAL_LO_ADDR A:0xa212030
y.create.l HWIO_WCSS_A_QTMR_V1_T0_QTMR_V1_CNTV_CVAL_HI_ADDR A:0xa212034
y.create.l HWIO_WCSS_A_QTMR_V1_T0_QTMR_V1_CNTV_TVAL_ADDR A:0xa212038
y.create.l HWIO_WCSS_A_QTMR_V1_T0_QTMR_V1_CNTV_CTL_ADDR A:0xa21203c
y.create.l HWIO_WCSS_A_QTMR_V1_T0_QTMR_V1_VERSION_ADDR A:0xa212fd0
y.create.l HWIO_WCSS_A_QTMR_V1_T1_QTMR_V1_CNTPCT_LO_ADDR A:0xa213000
y.create.l HWIO_WCSS_A_QTMR_V1_T1_QTMR_V1_CNTPCT_HI_ADDR A:0xa213004
y.create.l HWIO_WCSS_A_QTMR_V1_T1_QTMR_V1_CNTVCT_LO_ADDR A:0xa213008
y.create.l HWIO_WCSS_A_QTMR_V1_T1_QTMR_V1_CNTVCT_HI_ADDR A:0xa21300c
y.create.l HWIO_WCSS_A_QTMR_V1_T1_QTMR_V1_CNTFRQ_ADDR A:0xa213010
y.create.l HWIO_WCSS_A_QTMR_V1_T1_QTMR_V1_CNTPL0ACR_ADDR A:0xa213014
y.create.l HWIO_WCSS_A_QTMR_V1_T1_QTMR_V1_CNTVOFF_LO_ADDR A:0xa213018
y.create.l HWIO_WCSS_A_QTMR_V1_T1_QTMR_V1_CNTVOFF_HI_ADDR A:0xa21301c
y.create.l HWIO_WCSS_A_QTMR_V1_T1_QTMR_V1_CNTP_CVAL_LO_ADDR A:0xa213020
y.create.l HWIO_WCSS_A_QTMR_V1_T1_QTMR_V1_CNTP_CVAL_HI_ADDR A:0xa213024
y.create.l HWIO_WCSS_A_QTMR_V1_T1_QTMR_V1_CNTP_TVAL_ADDR A:0xa213028
y.create.l HWIO_WCSS_A_QTMR_V1_T1_QTMR_V1_CNTP_CTL_ADDR A:0xa21302c
y.create.l HWIO_WCSS_A_QTMR_V1_T1_QTMR_V1_CNTV_CVAL_LO_ADDR A:0xa213030
y.create.l HWIO_WCSS_A_QTMR_V1_T1_QTMR_V1_CNTV_CVAL_HI_ADDR A:0xa213034
y.create.l HWIO_WCSS_A_QTMR_V1_T1_QTMR_V1_CNTV_TVAL_ADDR A:0xa213038
y.create.l HWIO_WCSS_A_QTMR_V1_T1_QTMR_V1_CNTV_CTL_ADDR A:0xa21303c
y.create.l HWIO_WCSS_A_QTMR_V1_T1_QTMR_V1_VERSION_ADDR A:0xa213fd0
y.create.l HWIO_WCSS_A_QTMR_V1_T2_QTMR_V1_CNTPCT_LO_ADDR A:0xa214000
y.create.l HWIO_WCSS_A_QTMR_V1_T2_QTMR_V1_CNTPCT_HI_ADDR A:0xa214004
y.create.l HWIO_WCSS_A_QTMR_V1_T2_QTMR_V1_CNTVCT_LO_ADDR A:0xa214008
y.create.l HWIO_WCSS_A_QTMR_V1_T2_QTMR_V1_CNTVCT_HI_ADDR A:0xa21400c
y.create.l HWIO_WCSS_A_QTMR_V1_T2_QTMR_V1_CNTFRQ_ADDR A:0xa214010
y.create.l HWIO_WCSS_A_QTMR_V1_T2_QTMR_V1_CNTPL0ACR_ADDR A:0xa214014
y.create.l HWIO_WCSS_A_QTMR_V1_T2_QTMR_V1_CNTVOFF_LO_ADDR A:0xa214018
y.create.l HWIO_WCSS_A_QTMR_V1_T2_QTMR_V1_CNTVOFF_HI_ADDR A:0xa21401c
y.create.l HWIO_WCSS_A_QTMR_V1_T2_QTMR_V1_CNTP_CVAL_LO_ADDR A:0xa214020
y.create.l HWIO_WCSS_A_QTMR_V1_T2_QTMR_V1_CNTP_CVAL_HI_ADDR A:0xa214024
y.create.l HWIO_WCSS_A_QTMR_V1_T2_QTMR_V1_CNTP_TVAL_ADDR A:0xa214028
y.create.l HWIO_WCSS_A_QTMR_V1_T2_QTMR_V1_CNTP_CTL_ADDR A:0xa21402c
y.create.l HWIO_WCSS_A_QTMR_V1_T2_QTMR_V1_CNTV_CVAL_LO_ADDR A:0xa214030
y.create.l HWIO_WCSS_A_QTMR_V1_T2_QTMR_V1_CNTV_CVAL_HI_ADDR A:0xa214034
y.create.l HWIO_WCSS_A_QTMR_V1_T2_QTMR_V1_CNTV_TVAL_ADDR A:0xa214038
y.create.l HWIO_WCSS_A_QTMR_V1_T2_QTMR_V1_CNTV_CTL_ADDR A:0xa21403c
y.create.l HWIO_WCSS_A_QTMR_V1_T2_QTMR_V1_VERSION_ADDR A:0xa214fd0
y.create.l HWIO_WCSS_A_QTMR_V1_T3_QTMR_V1_CNTPCT_LO_ADDR A:0xa215000
y.create.l HWIO_WCSS_A_QTMR_V1_T3_QTMR_V1_CNTPCT_HI_ADDR A:0xa215004
y.create.l HWIO_WCSS_A_QTMR_V1_T3_QTMR_V1_CNTVCT_LO_ADDR A:0xa215008
y.create.l HWIO_WCSS_A_QTMR_V1_T3_QTMR_V1_CNTVCT_HI_ADDR A:0xa21500c
y.create.l HWIO_WCSS_A_QTMR_V1_T3_QTMR_V1_CNTFRQ_ADDR A:0xa215010
y.create.l HWIO_WCSS_A_QTMR_V1_T3_QTMR_V1_CNTPL0ACR_ADDR A:0xa215014
y.create.l HWIO_WCSS_A_QTMR_V1_T3_QTMR_V1_CNTVOFF_LO_ADDR A:0xa215018
y.create.l HWIO_WCSS_A_QTMR_V1_T3_QTMR_V1_CNTVOFF_HI_ADDR A:0xa21501c
y.create.l HWIO_WCSS_A_QTMR_V1_T3_QTMR_V1_CNTP_CVAL_LO_ADDR A:0xa215020
y.create.l HWIO_WCSS_A_QTMR_V1_T3_QTMR_V1_CNTP_CVAL_HI_ADDR A:0xa215024
y.create.l HWIO_WCSS_A_QTMR_V1_T3_QTMR_V1_CNTP_TVAL_ADDR A:0xa215028
y.create.l HWIO_WCSS_A_QTMR_V1_T3_QTMR_V1_CNTP_CTL_ADDR A:0xa21502c
y.create.l HWIO_WCSS_A_QTMR_V1_T3_QTMR_V1_CNTV_CVAL_LO_ADDR A:0xa215030
y.create.l HWIO_WCSS_A_QTMR_V1_T3_QTMR_V1_CNTV_CVAL_HI_ADDR A:0xa215034
y.create.l HWIO_WCSS_A_QTMR_V1_T3_QTMR_V1_CNTV_TVAL_ADDR A:0xa215038
y.create.l HWIO_WCSS_A_QTMR_V1_T3_QTMR_V1_CNTV_CTL_ADDR A:0xa21503c
y.create.l HWIO_WCSS_A_QTMR_V1_T3_QTMR_V1_VERSION_ADDR A:0xa215fd0
y.create.l HWIO_WCSS_A_QTMR_V1_T4_QTMR_V1_CNTPCT_LO_ADDR A:0xa216000
y.create.l HWIO_WCSS_A_QTMR_V1_T4_QTMR_V1_CNTPCT_HI_ADDR A:0xa216004
y.create.l HWIO_WCSS_A_QTMR_V1_T4_QTMR_V1_CNTVCT_LO_ADDR A:0xa216008
y.create.l HWIO_WCSS_A_QTMR_V1_T4_QTMR_V1_CNTVCT_HI_ADDR A:0xa21600c
y.create.l HWIO_WCSS_A_QTMR_V1_T4_QTMR_V1_CNTFRQ_ADDR A:0xa216010
y.create.l HWIO_WCSS_A_QTMR_V1_T4_QTMR_V1_CNTPL0ACR_ADDR A:0xa216014
y.create.l HWIO_WCSS_A_QTMR_V1_T4_QTMR_V1_CNTVOFF_LO_ADDR A:0xa216018
y.create.l HWIO_WCSS_A_QTMR_V1_T4_QTMR_V1_CNTVOFF_HI_ADDR A:0xa21601c
y.create.l HWIO_WCSS_A_QTMR_V1_T4_QTMR_V1_CNTP_CVAL_LO_ADDR A:0xa216020
y.create.l HWIO_WCSS_A_QTMR_V1_T4_QTMR_V1_CNTP_CVAL_HI_ADDR A:0xa216024
y.create.l HWIO_WCSS_A_QTMR_V1_T4_QTMR_V1_CNTP_TVAL_ADDR A:0xa216028
y.create.l HWIO_WCSS_A_QTMR_V1_T4_QTMR_V1_CNTP_CTL_ADDR A:0xa21602c
y.create.l HWIO_WCSS_A_QTMR_V1_T4_QTMR_V1_CNTV_CVAL_LO_ADDR A:0xa216030
y.create.l HWIO_WCSS_A_QTMR_V1_T4_QTMR_V1_CNTV_CVAL_HI_ADDR A:0xa216034
y.create.l HWIO_WCSS_A_QTMR_V1_T4_QTMR_V1_CNTV_TVAL_ADDR A:0xa216038
y.create.l HWIO_WCSS_A_QTMR_V1_T4_QTMR_V1_CNTV_CTL_ADDR A:0xa21603c
y.create.l HWIO_WCSS_A_QTMR_V1_T4_QTMR_V1_VERSION_ADDR A:0xa216fd0
y.create.l HWIO_WCSS_A_QGIC2_GICD_CTLR_ADDR A:0xa20a000
y.create.l HWIO_WCSS_A_QGIC2_GICD_TYPER_ADDR A:0xa20a004
y.create.l HWIO_WCSS_A_QGIC2_GICD_IIDR_ADDR A:0xa20a008
y.create.l HWIO_WCSS_A_QGIC2_GICD_ANSACR_ADDR A:0xa20a020
y.create.l HWIO_WCSS_A_QGIC2_GICD_CGCR_ADDR A:0xa20a024
y.create.l HWIO_WCSS_A_QGIC2_GICD_HW_VERSION_ADDR A:0xa20a030
y.create.l HWIO_WCSS_A_QGIC2_GICD_ISR0_ADDR A:0xa20a080
y.create.l HWIO_WCSS_A_QGIC2_GICD_ISR1_ADDR A:0xa20a084
y.create.l HWIO_WCSS_A_QGIC2_GICD_ISR2_ADDR A:0xa20a088
y.create.l HWIO_WCSS_A_QGIC2_GICD_ISR3_ADDR A:0xa20a08c
y.create.l HWIO_WCSS_A_QGIC2_GICD_ISR4_ADDR A:0xa20a090
y.create.l HWIO_WCSS_A_QGIC2_GICD_ISR5_ADDR A:0xa20a094
y.create.l HWIO_WCSS_A_QGIC2_GICD_ISR6_ADDR A:0xa20a098
y.create.l HWIO_WCSS_A_QGIC2_GICD_ISR7_ADDR A:0xa20a09c
y.create.l HWIO_WCSS_A_QGIC2_GICD_ISR8_ADDR A:0xa20a0a0
y.create.l HWIO_WCSS_A_QGIC2_GICD_ISENABLER0_ADDR A:0xa20a100
y.create.l HWIO_WCSS_A_QGIC2_GICD_ISENABLER1_ADDR A:0xa20a104
y.create.l HWIO_WCSS_A_QGIC2_GICD_ISENABLER2_ADDR A:0xa20a108
y.create.l HWIO_WCSS_A_QGIC2_GICD_ISENABLER3_ADDR A:0xa20a10c
y.create.l HWIO_WCSS_A_QGIC2_GICD_ISENABLER4_ADDR A:0xa20a110
y.create.l HWIO_WCSS_A_QGIC2_GICD_ISENABLER5_ADDR A:0xa20a114
y.create.l HWIO_WCSS_A_QGIC2_GICD_ISENABLER6_ADDR A:0xa20a118
y.create.l HWIO_WCSS_A_QGIC2_GICD_ISENABLER7_ADDR A:0xa20a11c
y.create.l HWIO_WCSS_A_QGIC2_GICD_ISENABLER8_ADDR A:0xa20a120
y.create.l HWIO_WCSS_A_QGIC2_GICD_ICENABLER0_ADDR A:0xa20a180
y.create.l HWIO_WCSS_A_QGIC2_GICD_ICENABLER1_ADDR A:0xa20a184
y.create.l HWIO_WCSS_A_QGIC2_GICD_ICENABLER2_ADDR A:0xa20a188
y.create.l HWIO_WCSS_A_QGIC2_GICD_ICENABLER3_ADDR A:0xa20a18c
y.create.l HWIO_WCSS_A_QGIC2_GICD_ICENABLER4_ADDR A:0xa20a190
y.create.l HWIO_WCSS_A_QGIC2_GICD_ICENABLER5_ADDR A:0xa20a194
y.create.l HWIO_WCSS_A_QGIC2_GICD_ICENABLER6_ADDR A:0xa20a198
y.create.l HWIO_WCSS_A_QGIC2_GICD_ICENABLER7_ADDR A:0xa20a19c
y.create.l HWIO_WCSS_A_QGIC2_GICD_ICENABLER8_ADDR A:0xa20a1a0
y.create.l HWIO_WCSS_A_QGIC2_GICD_ISPENDR0_ADDR A:0xa20a200
y.create.l HWIO_WCSS_A_QGIC2_GICD_ISPENDR1_ADDR A:0xa20a204
y.create.l HWIO_WCSS_A_QGIC2_GICD_ISPENDR2_ADDR A:0xa20a208
y.create.l HWIO_WCSS_A_QGIC2_GICD_ISPENDR3_ADDR A:0xa20a20c
y.create.l HWIO_WCSS_A_QGIC2_GICD_ISPENDR4_ADDR A:0xa20a210
y.create.l HWIO_WCSS_A_QGIC2_GICD_ISPENDR5_ADDR A:0xa20a214
y.create.l HWIO_WCSS_A_QGIC2_GICD_ISPENDR6_ADDR A:0xa20a218
y.create.l HWIO_WCSS_A_QGIC2_GICD_ISPENDR7_ADDR A:0xa20a21c
y.create.l HWIO_WCSS_A_QGIC2_GICD_ISPENDR8_ADDR A:0xa20a220
y.create.l HWIO_WCSS_A_QGIC2_GICD_ICPENDR0_ADDR A:0xa20a280
y.create.l HWIO_WCSS_A_QGIC2_GICD_ICPENDR1_ADDR A:0xa20a284
y.create.l HWIO_WCSS_A_QGIC2_GICD_ICPENDR2_ADDR A:0xa20a288
y.create.l HWIO_WCSS_A_QGIC2_GICD_ICPENDR3_ADDR A:0xa20a28c
y.create.l HWIO_WCSS_A_QGIC2_GICD_ICPENDR4_ADDR A:0xa20a290
y.create.l HWIO_WCSS_A_QGIC2_GICD_ICPENDR5_ADDR A:0xa20a294
y.create.l HWIO_WCSS_A_QGIC2_GICD_ICPENDR6_ADDR A:0xa20a298
y.create.l HWIO_WCSS_A_QGIC2_GICD_ICPENDR7_ADDR A:0xa20a29c
y.create.l HWIO_WCSS_A_QGIC2_GICD_ICPENDR8_ADDR A:0xa20a2a0
y.create.l HWIO_WCSS_A_QGIC2_GICD_ISACTIVER0_ADDR A:0xa20a300
y.create.l HWIO_WCSS_A_QGIC2_GICD_ISACTIVER1_ADDR A:0xa20a304
y.create.l HWIO_WCSS_A_QGIC2_GICD_ISACTIVER2_ADDR A:0xa20a308
y.create.l HWIO_WCSS_A_QGIC2_GICD_ISACTIVER3_ADDR A:0xa20a30c
y.create.l HWIO_WCSS_A_QGIC2_GICD_ISACTIVER4_ADDR A:0xa20a310
y.create.l HWIO_WCSS_A_QGIC2_GICD_ISACTIVER5_ADDR A:0xa20a314
y.create.l HWIO_WCSS_A_QGIC2_GICD_ISACTIVER6_ADDR A:0xa20a318
y.create.l HWIO_WCSS_A_QGIC2_GICD_ISACTIVER7_ADDR A:0xa20a31c
y.create.l HWIO_WCSS_A_QGIC2_GICD_ISACTIVER8_ADDR A:0xa20a320
y.create.l HWIO_WCSS_A_QGIC2_GICD_ICACTIVER0_ADDR A:0xa20a380
y.create.l HWIO_WCSS_A_QGIC2_GICD_ICACTIVER1_ADDR A:0xa20a384
y.create.l HWIO_WCSS_A_QGIC2_GICD_ICACTIVER2_ADDR A:0xa20a388
y.create.l HWIO_WCSS_A_QGIC2_GICD_ICACTIVER3_ADDR A:0xa20a38c
y.create.l HWIO_WCSS_A_QGIC2_GICD_ICACTIVER4_ADDR A:0xa20a390
y.create.l HWIO_WCSS_A_QGIC2_GICD_ICACTIVER5_ADDR A:0xa20a394
y.create.l HWIO_WCSS_A_QGIC2_GICD_ICACTIVER6_ADDR A:0xa20a398
y.create.l HWIO_WCSS_A_QGIC2_GICD_ICACTIVER7_ADDR A:0xa20a39c
y.create.l HWIO_WCSS_A_QGIC2_GICD_ICACTIVER8_ADDR A:0xa20a3a0
y.create.l HWIO_WCSS_A_QGIC2_GICD_IPRIORITYR0_ADDR A:0xa20a400
y.create.l HWIO_WCSS_A_QGIC2_GICD_IPRIORITYR1_ADDR A:0xa20a404
y.create.l HWIO_WCSS_A_QGIC2_GICD_IPRIORITYR2_ADDR A:0xa20a408
y.create.l HWIO_WCSS_A_QGIC2_GICD_IPRIORITYR3_ADDR A:0xa20a40c
y.create.l HWIO_WCSS_A_QGIC2_GICD_IPRIORITYR4_ADDR A:0xa20a410
y.create.l HWIO_WCSS_A_QGIC2_GICD_IPRIORITYR5_ADDR A:0xa20a414
y.create.l HWIO_WCSS_A_QGIC2_GICD_IPRIORITYR6_ADDR A:0xa20a418
y.create.l HWIO_WCSS_A_QGIC2_GICD_IPRIORITYR7_ADDR A:0xa20a41c
y.create.l HWIO_WCSS_A_QGIC2_GICD_IPRIORITYR8_ADDR A:0xa20a420
y.create.l HWIO_WCSS_A_QGIC2_GICD_IPRIORITYR9_ADDR A:0xa20a424
y.create.l HWIO_WCSS_A_QGIC2_GICD_ITARGETSR0_ADDR A:0xa20a800
y.create.l HWIO_WCSS_A_QGIC2_GICD_ITARGETSR1_ADDR A:0xa20a804
y.create.l HWIO_WCSS_A_QGIC2_GICD_ITARGETSR2_ADDR A:0xa20a808
y.create.l HWIO_WCSS_A_QGIC2_GICD_ITARGETSR3_ADDR A:0xa20a80c
y.create.l HWIO_WCSS_A_QGIC2_GICD_ITARGETSR4_ADDR A:0xa20a810
y.create.l HWIO_WCSS_A_QGIC2_GICD_ITARGETSR5_ADDR A:0xa20a814
y.create.l HWIO_WCSS_A_QGIC2_GICD_ITARGETSR6_ADDR A:0xa20a818
y.create.l HWIO_WCSS_A_QGIC2_GICD_ITARGETSR7_ADDR A:0xa20a81c
y.create.l HWIO_WCSS_A_QGIC2_GICD_ITARGETSR8_ADDR A:0xa20a820
y.create.l HWIO_WCSS_A_QGIC2_GICD_ITARGETSR9_ADDR A:0xa20a824
y.create.l HWIO_WCSS_A_QGIC2_GICD_ICFGR0_ADDR A:0xa20ac00
y.create.l HWIO_WCSS_A_QGIC2_GICD_ICFGR1_ADDR A:0xa20ac04
y.create.l HWIO_WCSS_A_QGIC2_GICD_ICFGR2_ADDR A:0xa20ac08
y.create.l HWIO_WCSS_A_QGIC2_GICD_ICFGR3_ADDR A:0xa20ac0c
y.create.l HWIO_WCSS_A_QGIC2_GICD_ICFGR4_ADDR A:0xa20ac10
y.create.l HWIO_WCSS_A_QGIC2_GICD_ICFGR5_ADDR A:0xa20ac14
y.create.l HWIO_WCSS_A_QGIC2_GICD_ICFGR6_ADDR A:0xa20ac18
y.create.l HWIO_WCSS_A_QGIC2_GICD_ICFGR7_ADDR A:0xa20ac1c
y.create.l HWIO_WCSS_A_QGIC2_GICD_ICFGR8_ADDR A:0xa20ac20
y.create.l HWIO_WCSS_A_QGIC2_GICD_ICFGR9_ADDR A:0xa20ac24
y.create.l HWIO_WCSS_A_QGIC2_GICD_SGIR_ADDR A:0xa20af00
y.create.l HWIO_WCSS_A_QGIC2_GICD_CPENDSGIR0_ADDR A:0xa20af10
y.create.l HWIO_WCSS_A_QGIC2_GICD_CPENDSGIR1_ADDR A:0xa20af14
y.create.l HWIO_WCSS_A_QGIC2_GICD_CPENDSGIR2_ADDR A:0xa20af18
y.create.l HWIO_WCSS_A_QGIC2_GICD_CPENDSGIR3_ADDR A:0xa20af1c
y.create.l HWIO_WCSS_A_QGIC2_GICD_SPENDSGIR0_ADDR A:0xa20af20
y.create.l HWIO_WCSS_A_QGIC2_GICD_SPENDSGIR1_ADDR A:0xa20af24
y.create.l HWIO_WCSS_A_QGIC2_GICD_SPENDSGIR2_ADDR A:0xa20af28
y.create.l HWIO_WCSS_A_QGIC2_GICD_SPENDSGIR3_ADDR A:0xa20af2c
y.create.l HWIO_WCSS_A_QGIC2_GICD_PIDR0_ADDR A:0xa20afd0
y.create.l HWIO_WCSS_A_QGIC2_GICD_PIDR1_ADDR A:0xa20afd4
y.create.l HWIO_WCSS_A_QGIC2_GICD_PIDR2_ADDR A:0xa20afd8
y.create.l HWIO_WCSS_A_QGIC2_GICD_PIDR3_ADDR A:0xa20afdc
y.create.l HWIO_WCSS_A_QGIC2_GICD_PIDR4_ADDR A:0xa20afe0
y.create.l HWIO_WCSS_A_QGIC2_GICD_PIDR5_ADDR A:0xa20afe4
y.create.l HWIO_WCSS_A_QGIC2_GICD_PIDR6_ADDR A:0xa20afe8
y.create.l HWIO_WCSS_A_QGIC2_GICD_PIDR7_ADDR A:0xa20afec
y.create.l HWIO_WCSS_A_QGIC2_GICD_CIDR0_ADDR A:0xa20aff0
y.create.l HWIO_WCSS_A_QGIC2_GICD_CIDR1_ADDR A:0xa20aff4
y.create.l HWIO_WCSS_A_QGIC2_GICD_CIDR2_ADDR A:0xa20aff8
y.create.l HWIO_WCSS_A_QGIC2_GICD_CIDR3_ADDR A:0xa20affc
y.create.l HWIO_WCSS_A_QGIC2_GICH_HCR_ADDR A:0xa20b000
y.create.l HWIO_WCSS_A_QGIC2_GICH_VTR_ADDR A:0xa20b004
y.create.l HWIO_WCSS_A_QGIC2_GICH_VMCR_ADDR A:0xa20b008
y.create.l HWIO_WCSS_A_QGIC2_GICH_MISR_ADDR A:0xa20b010
y.create.l HWIO_WCSS_A_QGIC2_GICH_EISR_ADDR A:0xa20b020
y.create.l HWIO_WCSS_A_QGIC2_GICH_ELRSR_ADDR A:0xa20b030
y.create.l HWIO_WCSS_A_QGIC2_GICH_APR_ADDR A:0xa20b0f0
y.create.l HWIO_WCSS_A_QGIC2_GICH_LR0_ADDR A:0xa20b100
y.create.l HWIO_WCSS_A_QGIC2_GICH_LR1_ADDR A:0xa20b104
y.create.l HWIO_WCSS_A_QGIC2_GICH_LR2_ADDR A:0xa20b108
y.create.l HWIO_WCSS_A_QGIC2_GICH_LR3_ADDR A:0xa20b10c
y.create.l HWIO_WCSS_A_QGIC2_GICH_SW_LR_ADDR A:0xa20b120
y.create.l HWIO_WCSS_A_QGIC2_GICC_CTLR_ADDR A:0xa20c000
y.create.l HWIO_WCSS_A_QGIC2_GICC_PMR_ADDR A:0xa20c004
y.create.l HWIO_WCSS_A_QGIC2_GICC_BPR_ADDR A:0xa20c008
y.create.l HWIO_WCSS_A_QGIC2_GICC_IAR_ADDR A:0xa20c00c
y.create.l HWIO_WCSS_A_QGIC2_GICC_EOIR_ADDR A:0xa20c010
y.create.l HWIO_WCSS_A_QGIC2_GICC_RPR_ADDR A:0xa20c014
y.create.l HWIO_WCSS_A_QGIC2_GICC_HPPIR_ADDR A:0xa20c018
y.create.l HWIO_WCSS_A_QGIC2_GICC_ABPR_ADDR A:0xa20c01c
y.create.l HWIO_WCSS_A_QGIC2_GICC_AIAR_ADDR A:0xa20c020
y.create.l HWIO_WCSS_A_QGIC2_GICC_AEOIR_ADDR A:0xa20c024
y.create.l HWIO_WCSS_A_QGIC2_GICC_AHPPIR_ADDR A:0xa20c028
y.create.l HWIO_WCSS_A_QGIC2_GICC_APR_ADDR A:0xa20c0d0
y.create.l HWIO_WCSS_A_QGIC2_GICC_NSAPR_ADDR A:0xa20c0e0
y.create.l HWIO_WCSS_A_QGIC2_GICC_IIDR_ADDR A:0xa20c0fc
y.create.l HWIO_WCSS_A_QGIC2_GICC_DIR_ADDR A:0xa20d000
y.create.l HWIO_WCSS_A_QGIC2_GICV_CTLR_ADDR A:0xa20e000
y.create.l HWIO_WCSS_A_QGIC2_GICV_PMR_ADDR A:0xa20e004
y.create.l HWIO_WCSS_A_QGIC2_GICV_BPR_ADDR A:0xa20e008
y.create.l HWIO_WCSS_A_QGIC2_GICV_IAR_ADDR A:0xa20e00c
y.create.l HWIO_WCSS_A_QGIC2_GICV_EOIR_ADDR A:0xa20e010
y.create.l HWIO_WCSS_A_QGIC2_GICV_RPR_ADDR A:0xa20e014
y.create.l HWIO_WCSS_A_QGIC2_GICV_HPPIR_ADDR A:0xa20e018
y.create.l HWIO_WCSS_A_QGIC2_GICV_ABPR_ADDR A:0xa20e01c
y.create.l HWIO_WCSS_A_QGIC2_GICV_AIAR_ADDR A:0xa20e020
y.create.l HWIO_WCSS_A_QGIC2_GICV_AEOIR_ADDR A:0xa20e024
y.create.l HWIO_WCSS_A_QGIC2_GICV_AHPPIR_ADDR A:0xa20e028
y.create.l HWIO_WCSS_A_QGIC2_GICV_APR_ADDR A:0xa20e0d0
y.create.l HWIO_WCSS_A_QGIC2_GICV_IIDR_ADDR A:0xa20e0fc
y.create.l HWIO_WCSS_A_QGIC2_GICV_DIR_ADDR A:0xa20f000
y.create.l HWIO_WCSS_A_LTE_CXM_CXM_WLAN_TX_GRANT_SEL_ADDR A:0xa208000
y.create.l HWIO_WCSS_A_LTE_CXM_CXM_WLAN_RX_GRANT_SEL_ADDR A:0xa208004
y.create.l HWIO_WCSS_A_LTE_CXM_CXM_WLAN_TX_RX_GRANT_EN_ADDR A:0xa208008
y.create.l HWIO_WCSS_A_LTE_CXM_CXM_TIMER_COUNTER_ADDR A:0xa20800c
y.create.l HWIO_WCSS_A_LTE_CXM_CXM_SW_CAPTURE_CLK_ADDR A:0xa208014
y.create.l HWIO_WCSS_A_LTE_CXM_CXM_SW_CAPTURE_SEL_ADDR A:0xa208018
y.create.l HWIO_WCSS_A_LTE_CXM_LTE_CXM_COUNTER_CAPTURED_ADDR A:0xa20801c
y.create.l HWIO_WCSS_A_LTE_CXM_CXM_CP_INTERRUPT_CTRL_ADDR A:0xa208020
y.create.l HWIO_WCSS_A_LTE_CXM_CXM_CP_INTERRUPT_MASK_N_ADDR A:0xa208024
y.create.l HWIO_WCSS_A_LTE_CXM_CXM_CP_INTERRUPT_RESET_N_ADDR A:0xa208028
y.create.l HWIO_WCSS_A_LTE_CXM_CXM_CP_INTERRUPT_STATUS_ADDR A:0xa20802c
y.create.l HWIO_WCSS_A_LTE_CXM_CXM_WLAN_TX_GRANT_ENABLE1_ADDR A:0xa208030
y.create.l HWIO_WCSS_A_LTE_CXM_CXM_WLAN_TX_GRANT_THRESHOLD1_ADDR A:0xa208034
y.create.l HWIO_WCSS_A_LTE_CXM_CXM_WLAN_TX_GRANT_VALUE1_ADDR A:0xa208038
y.create.l HWIO_WCSS_A_LTE_CXM_CXM_WLAN_TX_GRANT_ENABLE2_ADDR A:0xa20803c
y.create.l HWIO_WCSS_A_LTE_CXM_CXM_WLAN_TX_GRANT_THRESHOLD2_ADDR A:0xa208040
y.create.l HWIO_WCSS_A_LTE_CXM_CXM_WLAN_TX_GRANT_VALUE2_ADDR A:0xa208044
y.create.l HWIO_WCSS_A_LTE_CXM_CXM_WLAN_RX_GRANT_ENABLE1_ADDR A:0xa208048
y.create.l HWIO_WCSS_A_LTE_CXM_CXM_WLAN_RX_GRANT_THRESHOLD1_ADDR A:0xa20804c
y.create.l HWIO_WCSS_A_LTE_CXM_CXM_WLAN_RX_GRANT_VALUE1_ADDR A:0xa208050
y.create.l HWIO_WCSS_A_LTE_CXM_CXM_WLAN_RX_GRANT_ENABLE2_ADDR A:0xa208054
y.create.l HWIO_WCSS_A_LTE_CXM_CXM_WLAN_RX_GRANT_THRESHOLD2_ADDR A:0xa208058
y.create.l HWIO_WCSS_A_LTE_CXM_CXM_WLAN_RX_GRANT_VALUE2_ADDR A:0xa20805c
y.create.l HWIO_WCSS_A_LTE_CXM_CXM_BT_TX_GRANT_ENABLE1_ADDR A:0xa208060
y.create.l HWIO_WCSS_A_LTE_CXM_CXM_BT_TX_GRANT_THRESHOLD1_ADDR A:0xa208064
y.create.l HWIO_WCSS_A_LTE_CXM_CXM_BT_TX_GRANT_VALUE1_ADDR A:0xa208068
y.create.l HWIO_WCSS_A_LTE_CXM_CXM_BT_TX_GRANT_ENABLE2_ADDR A:0xa20806c
y.create.l HWIO_WCSS_A_LTE_CXM_CXM_BT_TX_GRANT_THRESHOLD2_ADDR A:0xa208070
y.create.l HWIO_WCSS_A_LTE_CXM_CXM_BT_TX_GRANT_VALUE2_ADDR A:0xa208074
y.create.l HWIO_WCSS_A_LTE_CXM_CXM_BT_RX_GRANT_ENABLE1_ADDR A:0xa208078
y.create.l HWIO_WCSS_A_LTE_CXM_CXM_BT_RX_GRANT_THRESHOLD1_ADDR A:0xa20807c
y.create.l HWIO_WCSS_A_LTE_CXM_CXM_BT_RX_GRANT_VALUE1_ADDR A:0xa208080
y.create.l HWIO_WCSS_A_LTE_CXM_CXM_BT_RX_GRANT_ENABLE2_ADDR A:0xa208084
y.create.l HWIO_WCSS_A_LTE_CXM_CXM_BT_RX_GRANT_THRESHOLD2_ADDR A:0xa208088
y.create.l HWIO_WCSS_A_LTE_CXM_CXM_BT_RX_GRANT_VALUE2_ADDR A:0xa20808c
y.create.l HWIO_WCSS_A_LTE_CXM_CXM_BT_RX_TX_GRANT_SEL_ADDR A:0xa208090
y.create.l HWIO_WCSS_A_LTE_CXM_CXM_BT_TX_RX_GRANT_EN_ADDR A:0xa208094
y.create.l HWIO_WCSS_A_LTE_CXM_CXM_CP_INTERRUPT_STROBE_0_START_COUNT_ADDR A:0xa208098
y.create.l HWIO_WCSS_A_LTE_CXM_CXM_CP_INTERRUPT_STROBE_1_START_COUNT_ADDR A:0xa20809c
y.create.l HWIO_WCSS_A_LTE_CXM_CXM_CP_INTERRUPT_STROBE_2_START_COUNT_ADDR A:0xa2080a0
y.create.l HWIO_WCSS_A_LTE_CXM_CXM_CP_INTERRUPT_STROBE_3_START_COUNT_ADDR A:0xa2080a4
y.create.l HWIO_WCSS_A_LTE_CXM_CXM_CP_INTERRUPT_STROBE_0_PERIODICITY_ADDR A:0xa2080a8
y.create.l HWIO_WCSS_A_LTE_CXM_CXM_CP_INTERRUPT_STROBE_1_PERIODICITY_ADDR A:0xa2080ac
y.create.l HWIO_WCSS_A_LTE_CXM_CXM_CP_INTERRUPT_STROBE_2_PERIODICITY_ADDR A:0xa2080b0
y.create.l HWIO_WCSS_A_LTE_CXM_CXM_CP_INTERRUPT_STROBE_3_PERIODICITY_ADDR A:0xa2080b4
y.create.l HWIO_WCSS_A_LTE_CXM_CXM_WCN_PRIORITY_ENABLES_ADDR A:0xa2080b8
y.create.l HWIO_WCSS_A_LTE_CXM_CXM_WCN_PRIORITY_THRESHOLD1_ADDR A:0xa2080bc
y.create.l HWIO_WCSS_A_LTE_CXM_CXM_WCN_PRIORITY_THRESHOLD2_ADDR A:0xa2080c0
y.create.l HWIO_WCSS_A_LTE_CXM_CXM_LTE_ACTIVE_FRAME_SYNC_VALUE_ADDR A:0xa2080c4
y.create.l HWIO_WCSS_A_SPDM_AHBTM_CFG_ADDR A:0xa203000
y.create.l HWIO_WCSS_A_SPDM_AHBTM_C0_CFG0_ADDR A:0xa203020
y.create.l HWIO_WCSS_A_SPDM_AHBTM_C1_CFG0_ADDR A:0xa203040
y.create.l HWIO_WCSS_A_SPDM_AHBTM_C2_CFG0_ADDR A:0xa203060
y.create.l HWIO_WCSS_A_SPDM_AHBTM_C3_CFG0_ADDR A:0xa203080
y.create.l HWIO_WCSS_A_SPDM_AHBTM_C4_CFG0_ADDR A:0xa2030a0
y.create.l HWIO_WCSS_A_SPDM_AHBTM_C5_CFG0_ADDR A:0xa2030c0
y.create.l HWIO_WCSS_A_SPDM_AHBTM_C6_CFG0_ADDR A:0xa2030e0
y.create.l HWIO_WCSS_A_SPDM_AHBTM_C7_CFG0_ADDR A:0xa203100
y.create.l HWIO_WCSS_A_SPDM_AHBTM_C0_CFG1_ADDR A:0xa203024
y.create.l HWIO_WCSS_A_SPDM_AHBTM_C1_CFG1_ADDR A:0xa203044
y.create.l HWIO_WCSS_A_SPDM_AHBTM_C2_CFG1_ADDR A:0xa203064
y.create.l HWIO_WCSS_A_SPDM_AHBTM_C3_CFG1_ADDR A:0xa203084
y.create.l HWIO_WCSS_A_SPDM_AHBTM_C4_CFG1_ADDR A:0xa2030a4
y.create.l HWIO_WCSS_A_SPDM_AHBTM_C5_CFG1_ADDR A:0xa2030c4
y.create.l HWIO_WCSS_A_SPDM_AHBTM_C6_CFG1_ADDR A:0xa2030e4
y.create.l HWIO_WCSS_A_SPDM_AHBTM_C7_CFG1_ADDR A:0xa203104
y.create.l HWIO_WCSS_A_SPDM_AHBTM_C0_CFG2_ADDR A:0xa203028
y.create.l HWIO_WCSS_A_SPDM_AHBTM_C1_CFG2_ADDR A:0xa203048
y.create.l HWIO_WCSS_A_SPDM_AHBTM_C2_CFG2_ADDR A:0xa203068
y.create.l HWIO_WCSS_A_SPDM_AHBTM_C3_CFG2_ADDR A:0xa203088
y.create.l HWIO_WCSS_A_SPDM_AHBTM_C4_CFG2_ADDR A:0xa2030a8
y.create.l HWIO_WCSS_A_SPDM_AHBTM_C5_CFG2_ADDR A:0xa2030c8
y.create.l HWIO_WCSS_A_SPDM_AHBTM_C6_CFG2_ADDR A:0xa2030e8
y.create.l HWIO_WCSS_A_SPDM_AHBTM_C7_CFG2_ADDR A:0xa203108
y.create.l HWIO_WCSS_A_SPDM_AHBTM_C0_CFG3_ADDR A:0xa20302c
y.create.l HWIO_WCSS_A_SPDM_AHBTM_C1_CFG3_ADDR A:0xa20304c
y.create.l HWIO_WCSS_A_SPDM_AHBTM_C2_CFG3_ADDR A:0xa20306c
y.create.l HWIO_WCSS_A_SPDM_AHBTM_C3_CFG3_ADDR A:0xa20308c
y.create.l HWIO_WCSS_A_SPDM_AHBTM_C4_CFG3_ADDR A:0xa2030ac
y.create.l HWIO_WCSS_A_SPDM_AHBTM_C5_CFG3_ADDR A:0xa2030cc
y.create.l HWIO_WCSS_A_SPDM_AHBTM_C6_CFG3_ADDR A:0xa2030ec
y.create.l HWIO_WCSS_A_SPDM_AHBTM_C7_CFG3_ADDR A:0xa20310c
y.create.l HWIO_WCSS_A_SPDM_AHBTM_C0_CFG4_ADDR A:0xa203030
y.create.l HWIO_WCSS_A_SPDM_AHBTM_C1_CFG4_ADDR A:0xa203050
y.create.l HWIO_WCSS_A_SPDM_AHBTM_C2_CFG4_ADDR A:0xa203070
y.create.l HWIO_WCSS_A_SPDM_AHBTM_C3_CFG4_ADDR A:0xa203090
y.create.l HWIO_WCSS_A_SPDM_AHBTM_C4_CFG4_ADDR A:0xa2030b0
y.create.l HWIO_WCSS_A_SPDM_AHBTM_C5_CFG4_ADDR A:0xa2030d0
y.create.l HWIO_WCSS_A_SPDM_AHBTM_C6_CFG4_ADDR A:0xa2030f0
y.create.l HWIO_WCSS_A_SPDM_AHBTM_C7_CFG4_ADDR A:0xa203110
y.create.l HWIO_WCSS_A_SPDM_AHBTM_C0_CFG5_ADDR A:0xa203034
y.create.l HWIO_WCSS_A_SPDM_AHBTM_C1_CFG5_ADDR A:0xa203054
y.create.l HWIO_WCSS_A_SPDM_AHBTM_C2_CFG5_ADDR A:0xa203074
y.create.l HWIO_WCSS_A_SPDM_AHBTM_C3_CFG5_ADDR A:0xa203094
y.create.l HWIO_WCSS_A_SPDM_AHBTM_C4_CFG5_ADDR A:0xa2030b4
y.create.l HWIO_WCSS_A_SPDM_AHBTM_C5_CFG5_ADDR A:0xa2030d4
y.create.l HWIO_WCSS_A_SPDM_AHBTM_C6_CFG5_ADDR A:0xa2030f4
y.create.l HWIO_WCSS_A_SPDM_AHBTM_C7_CFG5_ADDR A:0xa203114
y.create.l HWIO_WCSS_A_SPDM_AHBTM_C0_CFG6_ADDR A:0xa203038
y.create.l HWIO_WCSS_A_SPDM_AHBTM_C1_CFG6_ADDR A:0xa203058
y.create.l HWIO_WCSS_A_SPDM_AHBTM_C2_CFG6_ADDR A:0xa203078
y.create.l HWIO_WCSS_A_SPDM_AHBTM_C3_CFG6_ADDR A:0xa203098
y.create.l HWIO_WCSS_A_SPDM_AHBTM_C4_CFG6_ADDR A:0xa2030b8
y.create.l HWIO_WCSS_A_SPDM_AHBTM_C5_CFG6_ADDR A:0xa2030d8
y.create.l HWIO_WCSS_A_SPDM_AHBTM_C6_CFG6_ADDR A:0xa2030f8
y.create.l HWIO_WCSS_A_SPDM_AHBTM_C7_CFG6_ADDR A:0xa203118
y.create.l HWIO_WCSS_A_DXE_0_DMA_CSR_ADDR A:0xa202000
y.create.l HWIO_WCSS_A_DXE_0_DMA_ENCH_ADDR A:0xa202004
y.create.l HWIO_WCSS_A_DXE_0_DMA_CH_EN_ADDR A:0xa202008
y.create.l HWIO_WCSS_A_DXE_0_DMA_CH_DONE_ADDR A:0xa20200c
y.create.l HWIO_WCSS_A_DXE_0_DMA_CH_ERR_ADDR A:0xa202010
y.create.l HWIO_WCSS_A_DXE_0_DMA_CH_STOP_ADDR A:0xa202014
y.create.l HWIO_WCSS_A_DXE_0_INT_MSK_ADDR A:0xa202018
y.create.l HWIO_WCSS_A_DXE_0_INT_SRC_MSKD_ADDR A:0xa20201c
y.create.l HWIO_WCSS_A_DXE_0_INT_SRC_RAW_ADDR A:0xa202020
y.create.l HWIO_WCSS_A_DXE_0_INT_ED_SRC_ADDR A:0xa202024
y.create.l HWIO_WCSS_A_DXE_0_INT_DONE_SRC_ADDR A:0xa202028
y.create.l HWIO_WCSS_A_DXE_0_INT_ERR_SRC_ADDR A:0xa20202c
y.create.l HWIO_WCSS_A_DXE_0_INT_CLR_ADDR A:0xa202030
y.create.l HWIO_WCSS_A_DXE_0_INT_ED_CLR_ADDR A:0xa202034
y.create.l HWIO_WCSS_A_DXE_0_INT_DONE_CLR_ADDR A:0xa202038
y.create.l HWIO_WCSS_A_DXE_0_INT_ERR_CLR_ADDR A:0xa20203c
y.create.l HWIO_WCSS_A_DXE_0_DMA_CH_PRES_ADDR A:0xa202040
y.create.l HWIO_WCSS_A_DXE_0_TSTBUS_CTRL_ADDR A:0xa202044
y.create.l HWIO_WCSS_A_DXE_0_TSTBUS_LOW_ADDR A:0xa202048
y.create.l HWIO_WCSS_A_DXE_0_TSTBUS_HIGH_ADDR A:0xa20204c
y.create.l HWIO_WCSS_A_DXE_0_PF_BD_ADDR A:0xa202050
y.create.l HWIO_WCSS_A_DXE_0_PF_PDU_ADDR A:0xa202054
y.create.l HWIO_WCSS_A_DXE_0_REVISION_ADDR A:0xa202058
y.create.l HWIO_WCSS_A_DXE_0_BMU_SB_QDAT_AVAIL_ADDR A:0xa20205c
y.create.l HWIO_WCSS_A_DXE_0_BMU_SB_PDU_AVAIL_ADDR A:0xa202060
y.create.l HWIO_WCSS_A_DXE_0_STATE_ADDR A:0xa202064
y.create.l HWIO_WCSS_A_DXE_0_ARB_CH_MSK_ADDR A:0xa202068
y.create.l HWIO_WCSS_A_DXE_0_UIF_SB_ADDR A:0xa20206c
y.create.l HWIO_WCSS_A_DXE_0_TIMESTAMP_ADDR A:0xa202070
y.create.l HWIO_WCSS_A_DXE_0_ARB_CH_MSK_CLR_ADDR A:0xa202074
y.create.l HWIO_WCSS_A_DXE_0_CTR_PRES_ADDR A:0xa202078
y.create.l HWIO_WCSS_A_DXE_0_CTR_CLR_ADDR A:0xa20207c
y.create.l HWIO_WCSS_A_DXE_0_BD_TMPLTL_ADDR A:0xa202080
y.create.l HWIO_WCSS_A_DXE_0_BD_TMPLTH_ADDR A:0xa202084
y.create.l HWIO_WCSS_A_DXE_0_BDT_DAT_START_ADDR A:0xa202088
y.create.l HWIO_WCSS_A_DXE_0_COUNTER0_ADDR A:0xa202200
y.create.l HWIO_WCSS_A_DXE_0_COUNTER1_ADDR A:0xa202204
y.create.l HWIO_WCSS_A_DXE_0_COUNTER2_ADDR A:0xa202208
y.create.l HWIO_WCSS_A_DXE_0_COUNTER3_ADDR A:0xa20220c
y.create.l HWIO_WCSS_A_DXE_0_COUNTER4_ADDR A:0xa202210
y.create.l HWIO_WCSS_A_DXE_0_COUNTER5_ADDR A:0xa202214
y.create.l HWIO_WCSS_A_DXE_0_COUNTER6_ADDR A:0xa202218
y.create.l HWIO_WCSS_A_DXE_0_COUNTER7_ADDR A:0xa20221c
y.create.l HWIO_WCSS_A_DXE_0_CH0_CTRL_ADDR A:0xa202400
y.create.l HWIO_WCSS_A_DXE_0_CH0_STATUS_ADDR A:0xa202404
y.create.l HWIO_WCSS_A_DXE_0_CH0_SZ_ADDR A:0xa202408
y.create.l HWIO_WCSS_A_DXE_0_CH0_SADRL_ADDR A:0xa20240c
y.create.l HWIO_WCSS_A_DXE_0_CH0_SADRH_ADDR A:0xa202410
y.create.l HWIO_WCSS_A_DXE_0_CH0_DADRL_ADDR A:0xa202414
y.create.l HWIO_WCSS_A_DXE_0_CH0_DADRH_ADDR A:0xa202418
y.create.l HWIO_WCSS_A_DXE_0_CH0_DESCL_ADDR A:0xa20241c
y.create.l HWIO_WCSS_A_DXE_0_CH0_DESCH_ADDR A:0xa202420
y.create.l HWIO_WCSS_A_DXE_0_CH0_LST_DESCL_ADDR A:0xa202424
y.create.l HWIO_WCSS_A_DXE_0_CH0_LST_DESCH_ADDR A:0xa202428
y.create.l HWIO_WCSS_A_DXE_0_CH0_BD_ADDR A:0xa20242c
y.create.l HWIO_WCSS_A_DXE_0_CH0_HEAD_ADDR A:0xa202430
y.create.l HWIO_WCSS_A_DXE_0_CH0_TAIL_ADDR A:0xa202434
y.create.l HWIO_WCSS_A_DXE_0_CH0_PDU_ADDR A:0xa202438
y.create.l HWIO_WCSS_A_DXE_0_CH0_TSTMP_ADDR A:0xa20243c
y.create.l HWIO_WCSS_A_DXE_0_CH1_CTRL_ADDR A:0xa202440
y.create.l HWIO_WCSS_A_DXE_0_CH1_STATUS_ADDR A:0xa202444
y.create.l HWIO_WCSS_A_DXE_0_CH1_SZ_ADDR A:0xa202448
y.create.l HWIO_WCSS_A_DXE_0_CH1_SADRL_ADDR A:0xa20244c
y.create.l HWIO_WCSS_A_DXE_0_CH1_SADRH_ADDR A:0xa202450
y.create.l HWIO_WCSS_A_DXE_0_CH1_DADRL_ADDR A:0xa202454
y.create.l HWIO_WCSS_A_DXE_0_CH1_DADRH_ADDR A:0xa202458
y.create.l HWIO_WCSS_A_DXE_0_CH1_DESCL_ADDR A:0xa20245c
y.create.l HWIO_WCSS_A_DXE_0_CH1_DESCH_ADDR A:0xa202460
y.create.l HWIO_WCSS_A_DXE_0_CH1_LST_DESCL_ADDR A:0xa202464
y.create.l HWIO_WCSS_A_DXE_0_CH1_LST_DESCH_ADDR A:0xa202468
y.create.l HWIO_WCSS_A_DXE_0_CH1_BD_ADDR A:0xa20246c
y.create.l HWIO_WCSS_A_DXE_0_CH1_HEAD_ADDR A:0xa202470
y.create.l HWIO_WCSS_A_DXE_0_CH1_TAIL_ADDR A:0xa202474
y.create.l HWIO_WCSS_A_DXE_0_CH1_PDU_ADDR A:0xa202478
y.create.l HWIO_WCSS_A_DXE_0_CH1_TSTMP_ADDR A:0xa20247c
y.create.l HWIO_WCSS_A_DXE_0_CH2_CTRL_ADDR A:0xa202480
y.create.l HWIO_WCSS_A_DXE_0_CH2_STATUS_ADDR A:0xa202484
y.create.l HWIO_WCSS_A_DXE_0_CH2_SZ_ADDR A:0xa202488
y.create.l HWIO_WCSS_A_DXE_0_CH2_SADRL_ADDR A:0xa20248c
y.create.l HWIO_WCSS_A_DXE_0_CH2_SADRH_ADDR A:0xa202490
y.create.l HWIO_WCSS_A_DXE_0_CH2_DADRL_ADDR A:0xa202494
y.create.l HWIO_WCSS_A_DXE_0_CH2_DADRH_ADDR A:0xa202498
y.create.l HWIO_WCSS_A_DXE_0_CH2_DESCL_ADDR A:0xa20249c
y.create.l HWIO_WCSS_A_DXE_0_CH2_DESCH_ADDR A:0xa2024a0
y.create.l HWIO_WCSS_A_DXE_0_CH2_LST_DESCL_ADDR A:0xa2024a4
y.create.l HWIO_WCSS_A_DXE_0_CH2_LST_DESCH_ADDR A:0xa2024a8
y.create.l HWIO_WCSS_A_DXE_0_CH2_BD_ADDR A:0xa2024ac
y.create.l HWIO_WCSS_A_DXE_0_CH2_HEAD_ADDR A:0xa2024b0
y.create.l HWIO_WCSS_A_DXE_0_CH2_TAIL_ADDR A:0xa2024b4
y.create.l HWIO_WCSS_A_DXE_0_CH2_PDU_ADDR A:0xa2024b8
y.create.l HWIO_WCSS_A_DXE_0_CH2_TSTMP_ADDR A:0xa2024bc
y.create.l HWIO_WCSS_A_DXE_0_CH3_CTRL_ADDR A:0xa2024c0
y.create.l HWIO_WCSS_A_DXE_0_CH3_STATUS_ADDR A:0xa2024c4
y.create.l HWIO_WCSS_A_DXE_0_CH3_SZ_ADDR A:0xa2024c8
y.create.l HWIO_WCSS_A_DXE_0_CH3_SADRL_ADDR A:0xa2024cc
y.create.l HWIO_WCSS_A_DXE_0_CH3_SADRH_ADDR A:0xa2024d0
y.create.l HWIO_WCSS_A_DXE_0_CH3_DADRL_ADDR A:0xa2024d4
y.create.l HWIO_WCSS_A_DXE_0_CH3_DADRH_ADDR A:0xa2024d8
y.create.l HWIO_WCSS_A_DXE_0_CH3_DESCL_ADDR A:0xa2024dc
y.create.l HWIO_WCSS_A_DXE_0_CH3_DESCH_ADDR A:0xa2024e0
y.create.l HWIO_WCSS_A_DXE_0_CH3_LST_DESCL_ADDR A:0xa2024e4
y.create.l HWIO_WCSS_A_DXE_0_CH3_LST_DESCH_ADDR A:0xa2024e8
y.create.l HWIO_WCSS_A_DXE_0_CH3_BD_ADDR A:0xa2024ec
y.create.l HWIO_WCSS_A_DXE_0_CH3_HEAD_ADDR A:0xa2024f0
y.create.l HWIO_WCSS_A_DXE_0_CH3_TAIL_ADDR A:0xa2024f4
y.create.l HWIO_WCSS_A_DXE_0_CH3_PDU_ADDR A:0xa2024f8
y.create.l HWIO_WCSS_A_DXE_0_CH3_TSTMP_ADDR A:0xa2024fc
y.create.l HWIO_WCSS_A_DXE_0_CH4_CTRL_ADDR A:0xa202500
y.create.l HWIO_WCSS_A_DXE_0_CH4_STATUS_ADDR A:0xa202504
y.create.l HWIO_WCSS_A_DXE_0_CH4_SZ_ADDR A:0xa202508
y.create.l HWIO_WCSS_A_DXE_0_CH4_SADRL_ADDR A:0xa20250c
y.create.l HWIO_WCSS_A_DXE_0_CH4_SADRH_ADDR A:0xa202510
y.create.l HWIO_WCSS_A_DXE_0_CH4_DADRL_ADDR A:0xa202514
y.create.l HWIO_WCSS_A_DXE_0_CH4_DADRH_ADDR A:0xa202518
y.create.l HWIO_WCSS_A_DXE_0_CH4_DESCL_ADDR A:0xa20251c
y.create.l HWIO_WCSS_A_DXE_0_CH4_DESCH_ADDR A:0xa202520
y.create.l HWIO_WCSS_A_DXE_0_CH4_LST_DESCL_ADDR A:0xa202524
y.create.l HWIO_WCSS_A_DXE_0_CH4_LST_DESCH_ADDR A:0xa202528
y.create.l HWIO_WCSS_A_DXE_0_CH4_BD_ADDR A:0xa20252c
y.create.l HWIO_WCSS_A_DXE_0_CH4_HEAD_ADDR A:0xa202530
y.create.l HWIO_WCSS_A_DXE_0_CH4_TAIL_ADDR A:0xa202534
y.create.l HWIO_WCSS_A_DXE_0_CH4_PDU_ADDR A:0xa202538
y.create.l HWIO_WCSS_A_DXE_0_CH4_TSTMP_ADDR A:0xa20253c
y.create.l HWIO_WCSS_A_DXE_0_CH5_CTRL_ADDR A:0xa202540
y.create.l HWIO_WCSS_A_DXE_0_CH5_STATUS_ADDR A:0xa202544
y.create.l HWIO_WCSS_A_DXE_0_CH5_SZ_ADDR A:0xa202548
y.create.l HWIO_WCSS_A_DXE_0_CH5_SADRL_ADDR A:0xa20254c
y.create.l HWIO_WCSS_A_DXE_0_CH5_SADRH_ADDR A:0xa202550
y.create.l HWIO_WCSS_A_DXE_0_CH5_DADRL_ADDR A:0xa202554
y.create.l HWIO_WCSS_A_DXE_0_CH5_DADRH_ADDR A:0xa202558
y.create.l HWIO_WCSS_A_DXE_0_CH5_DESCL_ADDR A:0xa20255c
y.create.l HWIO_WCSS_A_DXE_0_CH5_DESCH_ADDR A:0xa202560
y.create.l HWIO_WCSS_A_DXE_0_CH5_LST_DESCL_ADDR A:0xa202564
y.create.l HWIO_WCSS_A_DXE_0_CH5_LST_DESCH_ADDR A:0xa202568
y.create.l HWIO_WCSS_A_DXE_0_CH5_BD_ADDR A:0xa20256c
y.create.l HWIO_WCSS_A_DXE_0_CH5_HEAD_ADDR A:0xa202570
y.create.l HWIO_WCSS_A_DXE_0_CH5_TAIL_ADDR A:0xa202574
y.create.l HWIO_WCSS_A_DXE_0_CH5_PDU_ADDR A:0xa202578
y.create.l HWIO_WCSS_A_DXE_0_CH5_TSTMP_ADDR A:0xa20257c
y.create.l HWIO_WCSS_A_DXE_0_CH6_CTRL_ADDR A:0xa202580
y.create.l HWIO_WCSS_A_DXE_0_CH6_STATUS_ADDR A:0xa202584
y.create.l HWIO_WCSS_A_DXE_0_CH6_SZ_ADDR A:0xa202588
y.create.l HWIO_WCSS_A_DXE_0_CH6_SADRL_ADDR A:0xa20258c
y.create.l HWIO_WCSS_A_DXE_0_CH6_SADRH_ADDR A:0xa202590
y.create.l HWIO_WCSS_A_DXE_0_CH6_DADRL_ADDR A:0xa202594
y.create.l HWIO_WCSS_A_DXE_0_CH6_DADRH_ADDR A:0xa202598
y.create.l HWIO_WCSS_A_DXE_0_CH6_DESCL_ADDR A:0xa20259c
y.create.l HWIO_WCSS_A_DXE_0_CH6_DESCH_ADDR A:0xa2025a0
y.create.l HWIO_WCSS_A_DXE_0_CH6_LST_DESCL_ADDR A:0xa2025a4
y.create.l HWIO_WCSS_A_DXE_0_CH6_LST_DESCH_ADDR A:0xa2025a8
y.create.l HWIO_WCSS_A_DXE_0_CH6_BD_ADDR A:0xa2025ac
y.create.l HWIO_WCSS_A_DXE_0_CH6_HEAD_ADDR A:0xa2025b0
y.create.l HWIO_WCSS_A_DXE_0_CH6_TAIL_ADDR A:0xa2025b4
y.create.l HWIO_WCSS_A_DXE_0_CH6_PDU_ADDR A:0xa2025b8
y.create.l HWIO_WCSS_A_DXE_0_CH6_TSTMP_ADDR A:0xa2025bc
y.create.l HWIO_WCSS_A_DXE_0_CH7_CTRL_ADDR A:0xa2025c0
y.create.l HWIO_WCSS_A_DXE_0_CH7_STATUS_ADDR A:0xa2025c4
y.create.l HWIO_WCSS_A_DXE_0_CH7_SZ_ADDR A:0xa2025c8
y.create.l HWIO_WCSS_A_DXE_0_CH7_SADRL_ADDR A:0xa2025cc
y.create.l HWIO_WCSS_A_DXE_0_CH7_SADRH_ADDR A:0xa2025d0
y.create.l HWIO_WCSS_A_DXE_0_CH7_DADRL_ADDR A:0xa2025d4
y.create.l HWIO_WCSS_A_DXE_0_CH7_DADRH_ADDR A:0xa2025d8
y.create.l HWIO_WCSS_A_DXE_0_CH7_DESCL_ADDR A:0xa2025dc
y.create.l HWIO_WCSS_A_DXE_0_CH7_DESCH_ADDR A:0xa2025e0
y.create.l HWIO_WCSS_A_DXE_0_CH7_LST_DESCL_ADDR A:0xa2025e4
y.create.l HWIO_WCSS_A_DXE_0_CH7_LST_DESCH_ADDR A:0xa2025e8
y.create.l HWIO_WCSS_A_DXE_0_CH7_BD_ADDR A:0xa2025ec
y.create.l HWIO_WCSS_A_DXE_0_CH7_HEAD_ADDR A:0xa2025f0
y.create.l HWIO_WCSS_A_DXE_0_CH7_TAIL_ADDR A:0xa2025f4
y.create.l HWIO_WCSS_A_DXE_0_CH7_PDU_ADDR A:0xa2025f8
y.create.l HWIO_WCSS_A_DXE_0_CH7_TSTMP_ADDR A:0xa2025fc
y.create.l HWIO_WCSS_A_CMEM_CMEM_INT_ADDR A:0xa201000
y.create.l HWIO_WCSS_A_CMEM_CMEM_INT_EN_ADDR A:0xa201004
y.create.l HWIO_WCSS_A_CMEM_CMEM_INT_CLR_ADDR A:0xa201008
y.create.l HWIO_WCSS_A_CMEM_CMEM_MEM_CFG_ADDR A:0xa20100c
y.create.l HWIO_WCSS_A_CMEM_CMEM_TRANSBLK_CODE_ADDR A:0xa201010
y.create.l HWIO_WCSS_A_CMEM_CMEM_TRANSBLK_START_ADDR_ADDR A:0xa201014
y.create.l HWIO_WCSS_A_CMEM_CMEM_TRANSBLK_END_ADDR_ADDR A:0xa201018
y.create.l HWIO_WCSS_A_CMEM_CMEM_TRANSBLK_PORT_EN_ADDR A:0xa20101c
y.create.l HWIO_WCSS_A_CMEM_CMEM_ARB_POLICY_ADDR A:0xa201020
y.create.l HWIO_WCSS_A_CMEM_CMEM_PRIORITY_ADDR A:0xa201024
y.create.l HWIO_WCSS_A_CMEM_CMEM_TEST_OUT_SEL_ADDR A:0xa201028
y.create.l HWIO_WCSS_A_CMEM_CMEM_INVALID_HISTORY_ADDR A:0xa20102c
y.create.l HWIO_WCSS_A_CMEM_CMEM_INVALID_ADDR0_ADDR A:0xa201030
y.create.l HWIO_WCSS_A_CMEM_CMEM_INVALID_ADDR1_ADDR A:0xa201034
y.create.l HWIO_WCSS_A_CMEM_CMEM_INVALID_ADDR2_ADDR A:0xa201038
y.create.l HWIO_WCSS_A_CMEM_CMEM_INVALID_ADDR3_ADDR A:0xa20103c
y.create.l HWIO_WCSS_A_CMEM_CMEM_INVALID_CTL_ADDR A:0xa201040
y.create.l HWIO_WCSS_A_CMEM_CMEM_SPARE_OUT_ADDR A:0xa201044
y.create.l HWIO_WCSS_A_CMEM_CMEM_CNT_CTRL_ADDR A:0xa201048
y.create.l HWIO_WCSS_A_CMEM_CMEM_CAHB_BUSY_CNT_ADDR A:0xa20104c
y.create.l HWIO_WCSS_A_CMEM_CMEM_CAHB_IDLE_CNT_ADDR A:0xa201050
y.create.l HWIO_WCSS_A_CMEM_CMEM_CAHB_ACTIVE_CNT_ADDR A:0xa201054
y.create.l HWIO_WCSS_A_CMEM_CMEM_DAHB_BUSY_CNT_ADDR A:0xa201058
y.create.l HWIO_WCSS_A_CMEM_CMEM_DAHB_IDLE_CNT_ADDR A:0xa20105c
y.create.l HWIO_WCSS_A_CMEM_CMEM_DAHB_ACTIVE_CNT_ADDR A:0xa201060
y.create.l HWIO_WCSS_A_CMEM_CMEM_ACPU_BUSY_CNT_ADDR A:0xa201064
y.create.l HWIO_WCSS_A_CMEM_CMEM_ACPU_IDLE_CNT_ADDR A:0xa201068
y.create.l HWIO_WCSS_A_CMEM_CMEM_ACPU_ACTIVE_CNT_ADDR A:0xa20106c
y.create.l HWIO_WCSS_A_CMEM_CMEM_TESTBUS_HI_ADDR A:0xa201070
y.create.l HWIO_WCSS_A_CMEM_CMEM_TESTBUS_LO_ADDR A:0xa201074
y.create.l HWIO_WCSS_A_CMEM_CMEM_CLK_GATE_ADDR A:0xa201078
y.create.l HWIO_WCSS_A_CMEM_CMEM_CAHB_RX_CTL_ADDR A:0xa20107c
y.create.l HWIO_WCSS_A_CMEM_CMEM_DAHB_RX_CTL_ADDR A:0xa201080
y.create.l HWIO_WCSS_A_CCAHB_CCAHB_BT_PL_ADDR A:0xa200000
y.create.l HWIO_WCSS_A_CCAHB_CCAHB_FM_PL_ADDR A:0xa200004
y.create.l HWIO_WCSS_A_CCAHB_CCAHB_RRI_PL_ADDR A:0xa200008
y.create.l HWIO_WCSS_A_CCAHB_CCAHB_DXE_PL_ADDR A:0xa20000c
y.create.l HWIO_WCSS_A_CCAHB_CCAHB_CCPU_PL_ADDR A:0xa200010
y.create.l HWIO_WCSS_A_CCAHB_CCAHB_A2AB_PL_ADDR A:0xa200014
y.create.l HWIO_WCSS_A_CCAHB_CCAHB_CBR_PL_ADDR A:0xa200018
y.create.l HWIO_WCSS_A_CCAHB_CCAHB_DFLT_MST_ADDR A:0xa200048
y.create.l HWIO_WCSS_A_CCAHB_CCAHB_VERSION_ADDR A:0xa200090
y.create.l HWIO_WCSS_A_FM_SSBI2_CFG_SSBI2_CTL_ADDR A:0xa1e0000
y.create.l HWIO_WCSS_A_FM_SSBI2_CFG_SSBI2_INT_ENABLE_ADDR A:0xa1e0004
y.create.l HWIO_WCSS_A_FM_SSBI2_CFG_SSBI2_PRIORITIES_ADDR A:0xa1e0008
y.create.l HWIO_WCSS_A_FM_SSBI2_CFG_SSBI2_BANKS_2_3_CTL_ADDR A:0xa1e000c
y.create.l HWIO_WCSS_A_FM_SSBI2_CFG_SSBI2_ILLEGAL_STATUS_ADDR A:0xa1e0010
y.create.l HWIO_WCSS_A_FM_SSBI2_CFG_SSBI2_TEST_BUS_CTL_ADDR A:0xa1e0014
y.create.l HWIO_WCSS_A_FM_SSBI2_CFG_SSBI2_VIT0_ADDR A:0xa1e0020
y.create.l HWIO_WCSS_A_FM_SSBI2_CFG_SSBI2_VIT1_ADDR A:0xa1e0024
y.create.l HWIO_WCSS_A_FM_SSBI2_CFG_SSBI2_VIT2_ADDR A:0xa1e0028
y.create.l HWIO_WCSS_A_FM_SSBI2_CFG_SSBI2_VIT3_ADDR A:0xa1e002c
y.create.l HWIO_WCSS_A_FM_SSBI2_CFG_SSBI2_VIT4_ADDR A:0xa1e0030
y.create.l HWIO_WCSS_A_FM_SSBI2_CFG_SSBI2_VIT5_ADDR A:0xa1e0034
y.create.l HWIO_WCSS_A_FM_SSBI2_CFG_SSBI2_VIT6_ADDR A:0xa1e0038
y.create.l HWIO_WCSS_A_FM_SSBI2_CFG_SSBI2_PVC_CTL_ADDR A:0xa1e00a0
y.create.l HWIO_WCSS_A_FM_SSBI2_CFG_SSBI2_PVC_TABLE0_ADDR A:0xa1e00a4
y.create.l HWIO_WCSS_A_FM_SSBI2_CFG_SSBI2_PVC_TABLE1_ADDR A:0xa1e00a8
y.create.l HWIO_WCSS_A_FM_SSBI2_CFG_SSBI2_PVC_TABLE2_ADDR A:0xa1e00ac
y.create.l HWIO_WCSS_A_FM_SSBI2_CFG_SSBI2_PVC_TABLE3_ADDR A:0xa1e00b0
y.create.l HWIO_WCSS_A_FM_SSBI2_CFG_SSBI2_PVC_TABLE4_ADDR A:0xa1e00b4
y.create.l HWIO_WCSS_A_FM_SSBI2_CFG_SSBI2_PVC_TABLE5_ADDR A:0xa1e00b8
y.create.l HWIO_WCSS_A_FM_SSBI2_CFG_SSBI2_PVC_TABLE6_ADDR A:0xa1e00bc
y.create.l HWIO_WCSS_A_FM_SSBI2_CFG_SSBI2_PVC_TABLE7_ADDR A:0xa1e00c0
y.create.l HWIO_WCSS_A_FM_SSBI2_CFG_SSBI2_PVC_TABLE8_ADDR A:0xa1e00c4
y.create.l HWIO_WCSS_A_FM_SSBI2_CFG_SSBI2_PVC_TABLE9_ADDR A:0xa1e00c8
y.create.l HWIO_WCSS_A_FM_SSBI2_CMD_SSBI2_CMD_ADDR A:0xa1c0000
y.create.l HWIO_WCSS_A_FM_SSBI2_CMD_SSBI2_RD_STATUS_ADDR A:0xa1c0004
y.create.l HWIO_WCSS_A_FM_TX_CONTROL_ADDR A:0xa180000
y.create.l HWIO_WCSS_A_FM_TX_MODULATION_ADDR A:0xa180004
y.create.l HWIO_WCSS_A_FM_TX_AUDIO_LIMIT_ADDR A:0xa180008
y.create.l HWIO_WCSS_A_FM_TX_RDS_CONTROL_ADDR A:0xa18000c
y.create.l HWIO_WCSS_A_FM_TX_RDS_BLK_DATA_A_B_ADDR A:0xa180010
y.create.l HWIO_WCSS_A_FM_TX_RDS_BLK_DATA_C_D_ADDR A:0xa180014
y.create.l HWIO_WCSS_A_FM_TX_SOFT_RESET_ADDR A:0xa180018
y.create.l HWIO_WCSS_A_FM_TX_TMUX_SEL_ADDR A:0xa18001c
y.create.l HWIO_WCSS_A_FM_RX_CONTROL_ADDR A:0xa190000
y.create.l HWIO_WCSS_A_FM_RX_SOFT_RESET_ADDR A:0xa190004
y.create.l HWIO_WCSS_A_FM_RX_TMUX_SEL_ADDR A:0xa190024
y.create.l HWIO_WCSS_A_FM_RX_DEMOD_GLITCH_THRESHOLD_ADDR A:0xa190028
y.create.l HWIO_WCSS_A_FM_RX_GLITCH_STOP_SRCH_CNT_ADDR A:0xa19002c
y.create.l HWIO_WCSS_A_FM_RX_GLITCH_START_SRCH_CNT_ADDR A:0xa190030
y.create.l HWIO_WCSS_A_FM_RX_GLITCH_BLANK_CNT_TH_ADDR A:0xa190034
y.create.l HWIO_WCSS_A_FM_RX_PLL_BANK_CHG_STB_ADDR A:0xa190038
y.create.l HWIO_WCSS_A_FM_RX_PHASE_COMP_BYPASS_ADDR A:0xa19003c
y.create.l HWIO_WCSS_A_FM_RX_MPX_DCC_CTRL_ADDR A:0xa190040
y.create.l HWIO_WCSS_A_FM_RX_MPX_DCC_Z_DELAY_REGISTER_ADDR A:0xa190044
y.create.l HWIO_WCSS_A_FM_RX_PILOT_DET_THRESHOLD_ADDR A:0xa190048
y.create.l HWIO_WCSS_A_FM_RX_DELTA_R57K_PHASE_ADJUST_ADDR A:0xa19004c
y.create.l HWIO_WCSS_A_FM_RX_BLEND_WEIGHT_ADDR A:0xa190050
y.create.l HWIO_WCSS_A_FM_RX_SOFTMUTE_WEIGHT_ADDR A:0xa190054
y.create.l HWIO_WCSS_A_FM_RX_BLEND_SOFTMUTE_LPF_M_SEL_ADDR A:0xa190058
y.create.l HWIO_WCSS_A_FM_RX_MS_DECODER_CNTL_ADDR A:0xa19005c
y.create.l HWIO_WCSS_A_FM_RX_MS_DECODER_STEREO_ON_ADDR A:0xa190060
y.create.l HWIO_WCSS_A_FM_RX_RDS_CTRL_ADDR A:0xa190064
y.create.l HWIO_WCSS_A_FM_RX_RDS_IQ_DET_CTRL_ADDR A:0xa190068
y.create.l HWIO_WCSS_A_FM_RX_RDS_ACQ_MODE_ADDR A:0xa19006c
y.create.l HWIO_WCSS_A_FM_RX_RDS_TRK_MODE_ADDR A:0xa190070
y.create.l HWIO_WCSS_A_FM_RX_RDS_STROBE_MARGIN_ADDR A:0xa190074
y.create.l HWIO_WCSS_A_FM_RX_RDS_MF_LPF_CNT_ADDR A:0xa190078
y.create.l HWIO_WCSS_A_FM_RX_RDS_IQ_AN_INT_DUR_SEL_ADDR A:0xa19007c
y.create.l HWIO_WCSS_A_FM_RX_RDS_IQ_ANALYZER_SELECT_ADDR A:0xa190080
y.create.l HWIO_WCSS_A_FM_RX_RDS_IQ_AN_DET_THRESH_ADDR A:0xa190084
y.create.l HWIO_WCSS_A_FM_RX_RDS_RECEIVE_MODE_SELECT_ADDR A:0xa190088
y.create.l HWIO_WCSS_A_FM_RX_RDS_STATUS_ADDR A:0xa19008c
y.create.l HWIO_WCSS_A_FM_RX_RDS_IQ_BUFFER_ADDR A:0xa190090
y.create.l HWIO_WCSS_A_FM_RX_RDS_TIME_TRACKING_THRESHOLD_ADDR A:0xa190094
y.create.l HWIO_WCSS_A_FM_RX_RDS_PEAK_INDEX_ADDR A:0xa190098
y.create.l HWIO_WCSS_A_FM_RX_RDS_DL_CONFIG_ADDR A:0xa19009c
y.create.l HWIO_WCSS_A_FM_RX_RDS_T1Q1E_ADDR A:0xa1900a0
y.create.l HWIO_WCSS_A_FM_RX_RDS_T1Q2E_ADDR A:0xa1900a4
y.create.l HWIO_WCSS_A_FM_RX_RDS_BLOCK_DATA_0_1_ADDR A:0xa1900a8
y.create.l HWIO_WCSS_A_FM_RX_RDS_BLOCK_DATA_2_3_ADDR A:0xa1900ac
y.create.l HWIO_WCSS_A_FM_RX_RDS_BLOCK_STATUS_ADDR A:0xa1900b0
y.create.l HWIO_WCSS_A_FM_RX_RDS_BLOCK_DATA_RAW_0_ADDR A:0xa1900b4
y.create.l HWIO_WCSS_A_FM_RX_RDS_BLOCK_DATA_RAW_1_ADDR A:0xa1900b8
y.create.l HWIO_WCSS_A_FM_RX_RDS_BLOCK_DATA_RAW_2_ADDR A:0xa1900bc
y.create.l HWIO_WCSS_A_FM_RX_RDS_BLOCK_DATA_RAW_3_ADDR A:0xa1900c0
y.create.l HWIO_WCSS_A_FM_RX_RDS_TMUX_SEL_ADDR A:0xa1900c4
y.create.l HWIO_WCSS_A_FM_RX_BLENDING_READBACK_ADDR A:0xa1900c8
y.create.l HWIO_WCSS_A_FM_RX_MUTE_READBACK_ADDR A:0xa1900cc
y.create.l HWIO_WCSS_A_FM_RX_PLL_FREERUN_EN_ADDR A:0xa1900d0
y.create.l HWIO_WCSS_A_FM_RX_ROT_CTRL_0_ADDR A:0xa1900d4
y.create.l HWIO_WCSS_A_FM_SPUR_COMP_FIXED_VALUE_0_ADDR A:0xa1900d8
y.create.l HWIO_WCSS_A_FM_DEMOD_DC_IF_OFFSET_ADDR A:0xa1900e0
y.create.l HWIO_WCSS_A_FM_SPUR_COMP_DC_VALUE_RD_BACK_0_ADDR A:0xa1900e4
y.create.l HWIO_WCSS_A_FM_SPUR_TRACK_INPUT_SEL_ADDR A:0xa190118
y.create.l HWIO_WCSS_A_FM_SPUR_TRACK_CMD_STATUS_ADDR A:0xa19011c
y.create.l HWIO_WCSS_A_FM_RX_ROT_CTRL_1_ADDR A:0xa190120
y.create.l HWIO_WCSS_A_FM_SPUR_COMP_FIXED_VALUE_1_ADDR A:0xa190124
y.create.l HWIO_WCSS_A_FM_SPUR_COMP_DC_VALUE_RD_BACK_1_ADDR A:0xa190128
y.create.l HWIO_WCSS_A_FM_RX_ROT_CTRL_2_ADDR A:0xa19012c
y.create.l HWIO_WCSS_A_FM_SPUR_COMP_FIXED_VALUE_2_ADDR A:0xa190130
y.create.l HWIO_WCSS_A_FM_SPUR_COMP_DC_VALUE_RD_BACK_2_ADDR A:0xa190134
y.create.l HWIO_WCSS_A_FM_GAS_GAM_CTRL_ADDR A:0xa1a0000
y.create.l HWIO_WCSS_A_FM_FM_INTR_EVENT_ADDR A:0xa1a0004
y.create.l HWIO_WCSS_A_FM_FM_INTR_ENABLE_ADDR A:0xa1a0008
y.create.l HWIO_WCSS_A_FM_FM_BUFFER_START_ADDRESS_ADDR A:0xa1a000c
y.create.l HWIO_WCSS_A_FM_FM_BUFFER_LENGTH_ADDR A:0xa1a0010
y.create.l HWIO_WCSS_A_FM_FM_BUFFER_HEAD_ADDR A:0xa1a0014
y.create.l HWIO_WCSS_A_FM_FM_BUFFER_TAIL_ADDR A:0xa1a0018
y.create.l HWIO_WCSS_A_FM_AUDIO_INTR_CONTROL_ADDR A:0xa1a001c
y.create.l HWIO_WCSS_A_FM_CLR_AUDIO_LEVEL_INTR_ADDR A:0xa1a0020
y.create.l HWIO_WCSS_A_FM_AUDIO_SAMPLES_COUNTER_VFR_SNAP_READBACK_ADDR A:0xa1a0024
y.create.l HWIO_WCSS_A_FM_AUDIO_SAMPLES_COUNTER_READBACK_ADDR A:0xa1a0028
y.create.l HWIO_WCSS_A_FM_SW_RESET_ADDR A:0xa1a002c
y.create.l HWIO_WCSS_A_FM_RIVA_TEST_MUX_ADDR A:0xa1a0030
y.create.l HWIO_WCSS_A_FM_SDI_CTRL_ADDR A:0xa1a0034
y.create.l HWIO_WCSS_A_FM_SCRAMBLER_CTRL_ADDR A:0xa1a0038
y.create.l HWIO_WCSS_A_FM_SCRAMBLER_POLY_ADDR A:0xa1a003c
y.create.l HWIO_WCSS_A_FM_FM_INTR_CTRL_ADDR A:0xa1a0040
y.create.l HWIO_WCSS_A_FM_AUDIO_DATA_CONTROL_ADDR A:0xa1a0044
y.create.l HWIO_WCSS_A_FM_FM_HW_VERSION_ADDR A:0xa1a0048
y.create.l HWIO_WCSS_A_FM_SPUR_TRK_START_ADDRESS_ADDR A:0xa1a0090
y.create.l HWIO_WCSS_A_FM_RX_AHB_ACCESS_ERROR_STATUS_ADDR A:0xa1a0094
y.create.l HWIO_WCSS_A_A2XB_A2XB_CFG_ADDR A:0xa100400
y.create.l HWIO_WCSS_A_A2XB_INT_MSK_ADDR A:0xa100404
y.create.l HWIO_WCSS_A_A2XB_INT_SRC_MSKD_ADDR A:0xa100408
y.create.l HWIO_WCSS_A_A2XB_INT_SRC_ADDR A:0xa10040c
y.create.l HWIO_WCSS_A_A2XB_INT_CLR_ADDR A:0xa100410
y.create.l HWIO_WCSS_A_A2XB_TSTBUS_CTRL_ADDR A:0xa100414
y.create.l HWIO_WCSS_A_A2XB_TSTBUS_ADDR A:0xa100418
y.create.l HWIO_WCSS_A_A2XB_ERR_INFO_ADDR A:0xa10041c
y.create.l HWIO_WCSS_A_A2XB_REVISION_ADDR A:0xa100420
y.create.l HWIO_WCSS_A_A2XB_SPARE_ADDR A:0xa100424
y.create.l HWIO_WCSS_A_A2XB_HALT_ADDR A:0xa100428
y.create.l HWIO_WCSS_A_A2XB_AXI_SB_CFG_ADDR A:0xa10042c
y.create.l HWIO_WCSS_A_ADU_CONTROL_ADDR A:0xa082800
y.create.l HWIO_WCSS_A_ADU_INTERRUPT_STATUS_ADDR A:0xa082804
y.create.l HWIO_WCSS_A_ADU_INTERRUPT_ENABLE_ADDR A:0xa082808
y.create.l HWIO_WCSS_A_ADU_ADU_TEST_CTRL_ADDR A:0xa08280c
y.create.l HWIO_WCSS_A_ADU_ADU_STATUS_ADDR A:0xa082810
y.create.l HWIO_WCSS_A_ADU_ADU_DEBUG0_ADDR A:0xa082814
y.create.l HWIO_WCSS_A_ADU_ADU_DEBUG1_ADDR A:0xa082818
y.create.l HWIO_WCSS_A_ADU_ADU_DEBUG2_ADDR A:0xa08281c
y.create.l HWIO_WCSS_A_ADU_ADU_COUNTERS1_ADDR A:0xa082820
y.create.l HWIO_WCSS_A_ADU_ADU_COUNTERS2_ADDR A:0xa082824
y.create.l HWIO_WCSS_A_ADU_ADU_COUNTERS3_ADDR A:0xa082828
y.create.l HWIO_WCSS_A_ADU_CONTROL2_ADDR A:0xa08282c
y.create.l HWIO_WCSS_A_ADU_TIMEOUT_READ_ADDR A:0xa082830
y.create.l HWIO_WCSS_A_ADU_UMA_CONFIG_ADDR A:0xa08283c
y.create.l HWIO_WCSS_A_ADU_UMA_CTRL_ADDR A:0xa082840
y.create.l HWIO_WCSS_A_ADU_UMA_DESP_TABLE_ADDR_ADDR A:0xa082844
y.create.l HWIO_WCSS_A_ADU_UMA_TX_ETHERTYPE_TABLE1_ADDR A:0xa082848
y.create.l HWIO_WCSS_A_ADU_UMA_TX_ETHERTYPE_TABLE2_ADDR A:0xa08284c
y.create.l HWIO_WCSS_A_ADU_UMA_RX_ETHERTYPE_TABLE1_ADDR A:0xa082850
y.create.l HWIO_WCSS_A_ADU_UMA_RX_ETHERTYPE_TABLE2_ADDR A:0xa082854
y.create.l HWIO_WCSS_A_ADU_UMA_TX_COUNTERS1_ADDR A:0xa082858
y.create.l HWIO_WCSS_A_ADU_UMA_TX_COUNTERS2_ADDR A:0xa08285c
y.create.l HWIO_WCSS_A_ADU_UMA_LLC_COUNTERS_ADDR A:0xa082860
y.create.l HWIO_WCSS_A_ADU_UMA_INDEX_TABLE_WDATA_U_ADDR A:0xa082864
y.create.l HWIO_WCSS_A_ADU_UMA_INDEX_TABLE_WDATA_L_ADDR A:0xa082868
y.create.l HWIO_WCSS_A_ADU_UMA_INDEX_TABLE_ADDR_CTRL_ADDR A:0xa08286c
y.create.l HWIO_WCSS_A_ADU_UMA_INDEX_TABLE_RDATA_U_ADDR A:0xa082870
y.create.l HWIO_WCSS_A_ADU_UMA_INDEX_TABLE_RDATA_L_ADDR A:0xa082874
y.create.l HWIO_WCSS_A_ADU_UMA_TX_DEFAULT_WMACADDR_U_ADDR A:0xa082878
y.create.l HWIO_WCSS_A_ADU_UMA_TX_DEFAULT_WMACADDR_L_ADDR A:0xa08287c
y.create.l HWIO_WCSS_A_ADU_UMA_CTRL2_ADDR A:0xa082880
y.create.l HWIO_WCSS_A_ADU_UMA_TX_COUNTERS3_ADDR A:0xa082884
y.create.l HWIO_WCSS_A_ADU_UMA_TX_WQ_QID_CTRL_ADDR A:0xa0828b8
y.create.l HWIO_WCSS_A_ADU_ADU_POLL_CMD_ERROR_ADDR_ADDR A:0xa0828c0
y.create.l HWIO_WCSS_A_ADU_ADU_SW_REG_REINIT_ADDR_ADDR A:0xa0828c4
y.create.l HWIO_WCSS_A_ADU_ADU_SW_REG_REINIT_TRIGGER_ADDR A:0xa0828c8
y.create.l HWIO_WCSS_A_ADU_UMA_TX_HTC_HT_ADDR A:0xa0828cc
y.create.l HWIO_WCSS_A_ADU_UMA_TX_HTC_VHT_ADDR A:0xa0828d0
y.create.l HWIO_WCSS_A_ADU_UMA_TX_TID_TO_QID_ADDR A:0xa0828d4
y.create.l HWIO_WCSS_A_ADU_UMA_TX_DEFAULT_WMACADDR_U_1_ADDR A:0xa0828d8
y.create.l HWIO_WCSS_A_ADU_UMA_TX_DEFAULT_WMACADDR_L_1_ADDR A:0xa0828dc
y.create.l HWIO_WCSS_A_ADU_UMA_TX_DEFAULT_WMACADDR_U_2_ADDR A:0xa0828e0
y.create.l HWIO_WCSS_A_ADU_UMA_TX_DEFAULT_WMACADDR_L_2_ADDR A:0xa0828e4
y.create.l HWIO_WCSS_A_ADU_UMA_TX_DEFAULT_WMACADDR_U_3_ADDR A:0xa0828e8
y.create.l HWIO_WCSS_A_ADU_UMA_TX_DEFAULT_WMACADDR_L_3_ADDR A:0xa0828ec
y.create.l HWIO_WCSS_A_ADU_UMA_TX_DEFAULT_STAID_ADDR A:0xa0828f0
y.create.l HWIO_WCSS_A_ADU_ADU_REINIT_CONFIG_ADDR A:0xa0828f4
y.create.l HWIO_WCSS_A_ADU_ADU_NON_AMSDU_LEN_ADDR A:0xa0828f8
y.create.l HWIO_WCSS_A_AGC_AGC_RESET_ADDR A:0xa013c00
y.create.l HWIO_WCSS_A_AGC_DIS_MODE_ADDR A:0xa013c04
y.create.l HWIO_WCSS_A_AGC_RX_OVERRIDE_ADDR A:0xa013c08
y.create.l HWIO_WCSS_A_AGC_PHY_LOOPBACK_ADDR A:0xa013c0c
y.create.l HWIO_WCSS_A_AGC_CONFIG_XBAR_ADDR A:0xa013c10
y.create.l HWIO_WCSS_A_AGC_CW_DETECT_ADDR A:0xa013c14
y.create.l HWIO_WCSS_A_AGC_CW_NOTCH_TIMEOUT_ADDR A:0xa013c18
y.create.l HWIO_WCSS_A_AGC_GAIN_MODE_ADDR A:0xa013c1c
y.create.l HWIO_WCSS_A_AGC_TESTBUS_ADDR A:0xa013c20
y.create.l HWIO_WCSS_A_AGC_GAINSET0_ADDR A:0xa013c24
y.create.l HWIO_WCSS_A_AGC_GAINSET_WRITE_ADDR A:0xa013c28
y.create.l HWIO_WCSS_A_AGC_STAT_CTRL_ADDR A:0xa013c2c
y.create.l HWIO_WCSS_A_AGC_SUBBAND_CONFIG_ADDR A:0xa013c30
y.create.l HWIO_WCSS_A_AGC_CHANNEL_FREQ_ADDR A:0xa013c34
y.create.l HWIO_WCSS_A_AGC_N_ACTIVE_ADDR A:0xa013c38
y.create.l HWIO_WCSS_A_AGC_N_LISTEN_ADDR A:0xa013c3c
y.create.l HWIO_WCSS_A_AGC_N_MEASURE_ADDR A:0xa013c40
y.create.l HWIO_WCSS_A_AGC_N_CAPTURE_ADDR A:0xa013c44
y.create.l HWIO_WCSS_A_AGC_CCA_MODE_ADDR A:0xa013c48
y.create.l HWIO_WCSS_A_AGC_CCA_GI_DET_CFG_ADDR A:0xa013c4c
y.create.l HWIO_WCSS_A_AGC_TH_CD20_ADDR A:0xa013c50
y.create.l HWIO_WCSS_A_AGC_TH_CD40_ADDR A:0xa013c54
y.create.l HWIO_WCSS_A_AGC_TH_CD80_ADDR A:0xa013c58
y.create.l HWIO_WCSS_A_AGC_TH_CS20_ADDR A:0xa013c5c
y.create.l HWIO_WCSS_A_AGC_TH_CS40_ADDR A:0xa013c60
y.create.l HWIO_WCSS_A_AGC_TH_CS80_ADDR A:0xa013c64
y.create.l HWIO_WCSS_A_AGC_TH_EDET_ADDR A:0xa013c68
y.create.l HWIO_WCSS_A_AGC_D_AGC_A_ADDR A:0xa013c6c
y.create.l HWIO_WCSS_A_AGC_D_AGC_B_ADDR A:0xa013c70
y.create.l HWIO_WCSS_A_AGC_RSSI_OFFSET0_ADDR A:0xa013c74
y.create.l HWIO_WCSS_A_AGC_RSSI_BT_OFFSET0_ADDR A:0xa013c78
y.create.l HWIO_WCSS_A_AGC_CLIP_COUNT_ADDR A:0xa013c7c
y.create.l HWIO_WCSS_A_AGC_SAT_COUNT_ADDR A:0xa013c80
y.create.l HWIO_WCSS_A_AGC_PIP_COUNT_ADDR A:0xa013c84
y.create.l HWIO_WCSS_A_AGC_RXA_NOT_AVALID_COUNT_ADDR A:0xa013c88
y.create.l HWIO_WCSS_A_AGC_RXA_HDR_INVALID_COUNT_ADDR A:0xa013c8c
y.create.l HWIO_WCSS_A_AGC_RXB_NO_B_PKT_DET_COUNT_ADDR A:0xa013c90
y.create.l HWIO_WCSS_A_AGC_RXB_INV_HDR_COUNT_ADDR A:0xa013c94
y.create.l HWIO_WCSS_A_AGC_RXB_ILL_HDR_COUNT_ADDR A:0xa013c98
y.create.l HWIO_WCSS_A_AGC_COARSE_DCO_UPDATE_COUNTER_ADDR A:0xa013c9c
y.create.l HWIO_WCSS_A_AGC_FALSE_AC_ABORT_COUNT_ADDR A:0xa013ca0
y.create.l HWIO_WCSS_A_AGC_LATE_AC_DET_COUNT_ADDR A:0xa013ca4
y.create.l HWIO_WCSS_A_AGC_CCA_PKTDET_STATUS_ADDR A:0xa013ca8
y.create.l HWIO_WCSS_A_AGC_SAMPLE_ADC_I0_ADDR A:0xa013cac
y.create.l HWIO_WCSS_A_AGC_SAMPLE_ADC_Q0_ADDR A:0xa013cb0
y.create.l HWIO_WCSS_A_AGC_ADC_RSSI0_ADDR A:0xa013cb4
y.create.l HWIO_WCSS_A_AGC_FIR_RSSI0_ADDR A:0xa013cb8
y.create.l HWIO_WCSS_A_AGC_COARSE_DCO_CHAIN0_REAL_ADDR A:0xa013cbc
y.create.l HWIO_WCSS_A_AGC_COARSE_DCO_CHAIN0_IMAG_ADDR A:0xa013cc0
y.create.l HWIO_WCSS_A_AGC_INIT_GAIN_ADDR A:0xa013cc4
y.create.l HWIO_WCSS_A_AGC_MAX_GAIN_ADDR A:0xa013cc8
y.create.l HWIO_WCSS_A_AGC_GAIN_OFFSET0_ADDR A:0xa013ccc
y.create.l HWIO_WCSS_A_AGC_TR_SW_GAIN_THRESH0_ADDR A:0xa013cd0
y.create.l HWIO_WCSS_A_AGC_SAT_STEP_ADDR A:0xa013cd4
y.create.l HWIO_WCSS_A_AGC_COARSE_STEP_HT_ADDR A:0xa013cd8
y.create.l HWIO_WCSS_A_AGC_COARSE_STEP_ADDR A:0xa013cdc
y.create.l HWIO_WCSS_A_AGC_MAX_POWER_DIFF_ADDR A:0xa013ce0
y.create.l HWIO_WCSS_A_AGC_TARGET_BO_ACTIVE_ADDR A:0xa013ce4
y.create.l HWIO_WCSS_A_AGC_TARGET_BO_INACTIVE_ADDR A:0xa013ce8
y.create.l HWIO_WCSS_A_AGC_TH_CLIP_HIGH_ADDR A:0xa013cec
y.create.l HWIO_WCSS_A_AGC_TH_CLIP_LOW_ADDR A:0xa013cf0
y.create.l HWIO_WCSS_A_AGC_TH_SIGNAL_HIGH_ADDR A:0xa013cf4
y.create.l HWIO_WCSS_A_AGC_TH_SIGNAL_LOW_ADDR A:0xa013cf8
y.create.l HWIO_WCSS_A_AGC_TH_HTSTS_CLIP_ADDR A:0xa013cfc
y.create.l HWIO_WCSS_A_AGC_TH_VHTSTS_CLIP_ADDR A:0xa013d00
y.create.l HWIO_WCSS_A_AGC_TH_POWER_CLIP_ADDR A:0xa013d04
y.create.l HWIO_WCSS_A_AGC_SAT_DELAY_ADDR A:0xa013d08
y.create.l HWIO_WCSS_A_AGC_CLIP_WINDOW_ADDR A:0xa013d0c
y.create.l HWIO_WCSS_A_AGC_TH_NO_SIGNAL_ADDR A:0xa013d10
y.create.l HWIO_WCSS_A_AGC_TH_DCO_CAL_ADDR A:0xa013d14
y.create.l HWIO_WCSS_A_AGC_DET_DATA_SHIFT_ADDR A:0xa013d18
y.create.l HWIO_WCSS_A_AGC_TH_RXB_PWR_HIGH_ADDR A:0xa013d1c
y.create.l HWIO_WCSS_A_AGC_TH_CW_LOW_ADDR A:0xa013d20
y.create.l HWIO_WCSS_A_AGC_TH_CW_HIGH_ADDR A:0xa013d24
y.create.l HWIO_WCSS_A_AGC_TH_CW_RSSI_ADDR A:0xa013d28
y.create.l HWIO_WCSS_A_AGC_CW_MODE_DELAY_ADDR A:0xa013d2c
y.create.l HWIO_WCSS_A_AGC_TH_D0_A_ADDR A:0xa013d30
y.create.l HWIO_WCSS_A_AGC_TH_D0_A_LOW_ADDR A:0xa013d34
y.create.l HWIO_WCSS_A_AGC_TH_D0_B_ADDR A:0xa013d38
y.create.l HWIO_WCSS_A_AGC_TH_D0_B_TF_EST_ADDR A:0xa013d3c
y.create.l HWIO_WCSS_A_AGC_TH_D0_11N_ADDR A:0xa013d40
y.create.l HWIO_WCSS_A_AGC_TH_D0_11N_LOW_ADDR A:0xa013d44
y.create.l HWIO_WCSS_A_AGC_TH_D0_11AC_ADDR A:0xa013d48
y.create.l HWIO_WCSS_A_AGC_TH_D0_11AC_LOW_ADDR A:0xa013d4c
y.create.l HWIO_WCSS_A_AGC_TH_MAXCORBA_ADDR A:0xa013d50
y.create.l HWIO_WCSS_A_AGC_TH_MAXCOR40_ADDR A:0xa013d54
y.create.l HWIO_WCSS_A_AGC_TH_MAXCORA40_ADDR A:0xa013d58
y.create.l HWIO_WCSS_A_AGC_TH_MAXCOR20_ADDR A:0xa013d5c
y.create.l HWIO_WCSS_A_AGC_TH_MAXCORA80_ADDR A:0xa013d60
y.create.l HWIO_WCSS_A_AGC_TH_MAXCORAB_ADDR A:0xa013d64
y.create.l HWIO_WCSS_A_AGC_C11B_ADDR A:0xa013d68
y.create.l HWIO_WCSS_A_AGC_C11BP_ADDR A:0xa013d6c
y.create.l HWIO_WCSS_A_AGC_TH_CAP_A_ADDR A:0xa013d70
y.create.l HWIO_WCSS_A_AGC_TH_CAP_B_ADDR A:0xa013d74
y.create.l HWIO_WCSS_A_AGC_TH_CAP_RXA_ADDR A:0xa013d78
y.create.l HWIO_WCSS_A_AGC_TH_CAP_RXB_ADDR A:0xa013d7c
y.create.l HWIO_WCSS_A_AGC_TH_PIP_PWR_JUMP_ADDR A:0xa013d80
y.create.l HWIO_WCSS_A_AGC_TH_EOP_LVL_DROP_ADDR A:0xa013d84
y.create.l HWIO_WCSS_A_AGC_TH_CORR_DROP_ADDR A:0xa013d88
y.create.l HWIO_WCSS_A_AGC_CORR_TIME_ADDR A:0xa013d8c
y.create.l HWIO_WCSS_A_AGC_ALL_RX_ON_TIME_ADDR A:0xa013d90
y.create.l HWIO_WCSS_A_AGC_TRIGGER_DELAY_ADDR A:0xa013d94
y.create.l HWIO_WCSS_A_AGC_PWR_NOTCH_ALPHA1_ADDR A:0xa013d98
y.create.l HWIO_WCSS_A_AGC_PWR_NOTCH_ALPHA2_ADDR A:0xa013d9c
y.create.l HWIO_WCSS_A_AGC_PWR_NOTCH_T_ALPHA_ADDR A:0xa013da0
y.create.l HWIO_WCSS_A_AGC_D_TX_SETTLE_ADDR A:0xa013da4
y.create.l HWIO_WCSS_A_AGC_D_UNSATURATED_ADDR A:0xa013da8
y.create.l HWIO_WCSS_A_AGC_D_SATURATED_ADDR A:0xa013dac
y.create.l HWIO_WCSS_A_AGC_D_FIRANDCAL_ADDR A:0xa013db0
y.create.l HWIO_WCSS_A_AGC_D_HT_STS_COARSE_MEAS_ADDR A:0xa013db4
y.create.l HWIO_WCSS_A_AGC_D_HT_STS_FINE_MEAS_ADDR A:0xa013db8
y.create.l HWIO_WCSS_A_AGC_D_VHT_STS_COARSE_MEAS_ADDR A:0xa013dbc
y.create.l HWIO_WCSS_A_AGC_D_VHT_STS_FINE_MEAS_ADDR A:0xa013dc0
y.create.l HWIO_WCSS_A_AGC_D_VHT_DET_TIME_ADDR A:0xa013dc4
y.create.l HWIO_WCSS_A_AGC_SIFS_TIME_A_ADDR A:0xa013dc8
y.create.l HWIO_WCSS_A_AGC_SIFS_TIME_B_ADDR A:0xa013dcc
y.create.l HWIO_WCSS_A_AGC_MAX_RX_TIME_A_ADDR A:0xa013dd0
y.create.l HWIO_WCSS_A_AGC_MAX_RX_TIME_B_ADDR A:0xa013dd4
y.create.l HWIO_WCSS_A_AGC_RTT_CFG_ADDR A:0xa013dd8
y.create.l HWIO_WCSS_A_AGC_RTT_SIFS_WINDOW_ADDR A:0xa013ddc
y.create.l HWIO_WCSS_A_AGC_RTT_OFFSET_20_ADDR A:0xa013de0
y.create.l HWIO_WCSS_A_AGC_RTT_OFFSET_40_ADDR A:0xa013de4
y.create.l HWIO_WCSS_A_AGC_RTT_OFFSET_80_ADDR A:0xa013de8
y.create.l HWIO_WCSS_A_AGC_RTT_VALID_COUNT_ADDR A:0xa013dec
y.create.l HWIO_WCSS_A_AGC_RTT_DELTA_MEAS_ADDR A:0xa013df0
y.create.l HWIO_WCSS_A_AGC_RTT_REF_TIME_MEAS_LS16_ADDR A:0xa013df4
y.create.l HWIO_WCSS_A_AGC_RTT_REF_TIME_MEAS_MS16_ADDR A:0xa013df8
y.create.l HWIO_WCSS_A_AGC_RDET_RSSI_THRESHOLD_ADDR A:0xa013dfc
y.create.l HWIO_WCSS_A_AGC_RDET_MIN_IAT_WRITE_ADDR A:0xa013e00
y.create.l HWIO_WCSS_A_AGC_RDET_MAX_IAT_WRITE_ADDR A:0xa013e04
y.create.l HWIO_WCSS_A_AGC_RDET_PULSE_WIDTH_MARGIN_WRITE_ADDR A:0xa013e08
y.create.l HWIO_WCSS_A_AGC_RDET_MIN_PULSE_TRAIN_COUNT1_WRITE_ADDR A:0xa013e0c
y.create.l HWIO_WCSS_A_AGC_RDET_MIN_PULSE_TRAIN_COUNT2_WRITE_ADDR A:0xa013e10
y.create.l HWIO_WCSS_A_AGC_RDET_MIN_PULSE_TRAIN_COUNT3_WRITE_ADDR A:0xa013e14
y.create.l HWIO_WCSS_A_AGC_RDET_MIN_PULSE_TRAIN_COUNT4_WRITE_ADDR A:0xa013e18
y.create.l HWIO_WCSS_A_AGC_RDET_MIN_RADAR_PULSE_WIDTH_WRITE_ADDR A:0xa013e1c
y.create.l HWIO_WCSS_A_AGC_RDET_MAX_RADAR_PULSE_WIDTH_WRITE_ADDR A:0xa013e20
y.create.l HWIO_WCSS_A_AGC_RDET_MIN_IAT_READ_ADDR A:0xa013e24
y.create.l HWIO_WCSS_A_AGC_RDET_MAX_IAT_READ_ADDR A:0xa013e28
y.create.l HWIO_WCSS_A_AGC_RDET_PULSE_WIDTH_MARGIN_READ_ADDR A:0xa013e2c
y.create.l HWIO_WCSS_A_AGC_RDET_MIN_PULSE_TRAIN_COUNT1_READ_ADDR A:0xa013e30
y.create.l HWIO_WCSS_A_AGC_RDET_MIN_PULSE_TRAIN_COUNT2_READ_ADDR A:0xa013e34
y.create.l HWIO_WCSS_A_AGC_RDET_MIN_PULSE_TRAIN_COUNT3_READ_ADDR A:0xa013e38
y.create.l HWIO_WCSS_A_AGC_RDET_MIN_PULSE_TRAIN_COUNT4_READ_ADDR A:0xa013e3c
y.create.l HWIO_WCSS_A_AGC_RDET_MIN_RADAR_PULSE_WIDTH_READ_ADDR A:0xa013e40
y.create.l HWIO_WCSS_A_AGC_RDET_MAX_RADAR_PULSE_WIDTH_READ_ADDR A:0xa013e44
y.create.l HWIO_WCSS_A_AGC_RDET_RESET_ADDR A:0xa013e48
y.create.l HWIO_WCSS_A_AGC_RDET_RADAR_DETECTED_ADDR A:0xa013e4c
y.create.l HWIO_WCSS_A_AGC_RDET_PULSEWIDTH_ADDR A:0xa013e50
y.create.l HWIO_WCSS_A_AGC_RDET_NUM_DETECTED_ADDR A:0xa013e54
y.create.l HWIO_WCSS_A_AGC_RDET_MEASUREMENT_DELAY_ADDR A:0xa013e58
y.create.l HWIO_WCSS_A_AGC_RDET_FLAG_RESET_ADDR A:0xa013e5c
y.create.l HWIO_WCSS_A_AGC_RSSI_THRESHOLD_CLIPPED_ADDR A:0xa013e60
y.create.l HWIO_WCSS_A_AGC_CW_PULSE_WIDTH_ADDR A:0xa013e64
y.create.l HWIO_WCSS_A_AGC_CW_RADAR_ADDR A:0xa013e68
y.create.l HWIO_WCSS_A_AGC_ACI_DETECT_TH_ADDR A:0xa013e6c
y.create.l HWIO_WCSS_A_AGC_TRANSITION_COUNT_GLOBAL_EN_ADDR A:0xa013e70
y.create.l HWIO_WCSS_A_AGC_TRANSITION_COUNT0_EN_ADDR A:0xa013e74
y.create.l HWIO_WCSS_A_AGC_TRANSITION_COUNT1_EN_ADDR A:0xa013e78
y.create.l HWIO_WCSS_A_AGC_TRANSITION_COUNT2_EN_ADDR A:0xa013e7c
y.create.l HWIO_WCSS_A_AGC_TRANSITION_COUNT3_EN_ADDR A:0xa013e80
y.create.l HWIO_WCSS_A_AGC_TRANSITION_COUNT4_EN_ADDR A:0xa013e84
y.create.l HWIO_WCSS_A_AGC_TRANSITION_COUNT5_EN_ADDR A:0xa013e88
y.create.l HWIO_WCSS_A_AGC_TRANSITION_COUNT6_EN_ADDR A:0xa013e8c
y.create.l HWIO_WCSS_A_AGC_TRANSITION_COUNT7_EN_ADDR A:0xa013e90
y.create.l HWIO_WCSS_A_AGC_TRANSITION_COUNT8_EN_ADDR A:0xa013e94
y.create.l HWIO_WCSS_A_AGC_TRANSITION_COUNT9_EN_ADDR A:0xa013e98
y.create.l HWIO_WCSS_A_AGC_TRANSITION_COUNT10_EN_ADDR A:0xa013e9c
y.create.l HWIO_WCSS_A_AGC_TRANSITION_COUNT11_EN_ADDR A:0xa013ea0
y.create.l HWIO_WCSS_A_AGC_TRANSITION_COUNT0_ADDR A:0xa013ea4
y.create.l HWIO_WCSS_A_AGC_TRANSITION_COUNT1_ADDR A:0xa013ea8
y.create.l HWIO_WCSS_A_AGC_TRANSITION_COUNT2_ADDR A:0xa013eac
y.create.l HWIO_WCSS_A_AGC_TRANSITION_COUNT3_ADDR A:0xa013eb0
y.create.l HWIO_WCSS_A_AGC_TRANSITION_COUNT4_ADDR A:0xa013eb4
y.create.l HWIO_WCSS_A_AGC_TRANSITION_COUNT5_ADDR A:0xa013eb8
y.create.l HWIO_WCSS_A_AGC_TRANSITION_COUNT6_ADDR A:0xa013ebc
y.create.l HWIO_WCSS_A_AGC_TRANSITION_COUNT7_ADDR A:0xa013ec0
y.create.l HWIO_WCSS_A_AGC_TRANSITION_COUNT8_ADDR A:0xa013ec4
y.create.l HWIO_WCSS_A_AGC_TRANSITION_COUNT9_ADDR A:0xa013ec8
y.create.l HWIO_WCSS_A_AGC_TRANSITION_COUNT10_ADDR A:0xa013ecc
y.create.l HWIO_WCSS_A_AGC_TRANSITION_COUNT11_ADDR A:0xa013ed0
y.create.l HWIO_WCSS_A_AGC_NOISE_HIST_CTRL_ADDR A:0xa013ed4
y.create.l HWIO_WCSS_A_AGC_NOISE_HIST_BIN0_MSW_ADDR A:0xa013ed8
y.create.l HWIO_WCSS_A_AGC_NOISE_HIST_BIN0_LSW_ADDR A:0xa013edc
y.create.l HWIO_WCSS_A_AGC_NOISE_HIST_BIN1_MSW_ADDR A:0xa013ee0
y.create.l HWIO_WCSS_A_AGC_NOISE_HIST_BIN1_LSW_ADDR A:0xa013ee4
y.create.l HWIO_WCSS_A_AGC_NOISE_HIST_BIN2_MSW_ADDR A:0xa013ee8
y.create.l HWIO_WCSS_A_AGC_NOISE_HIST_BIN2_LSW_ADDR A:0xa013eec
y.create.l HWIO_WCSS_A_AGC_NOISE_HIST_BIN3_MSW_ADDR A:0xa013ef0
y.create.l HWIO_WCSS_A_AGC_NOISE_HIST_BIN3_LSW_ADDR A:0xa013ef4
y.create.l HWIO_WCSS_A_AGC_NOISE_HIST_BIN4_MSW_ADDR A:0xa013ef8
y.create.l HWIO_WCSS_A_AGC_NOISE_HIST_BIN4_LSW_ADDR A:0xa013efc
y.create.l HWIO_WCSS_A_AGC_NOISE_HIST_BIN5_MSW_ADDR A:0xa013f00
y.create.l HWIO_WCSS_A_AGC_NOISE_HIST_BIN5_LSW_ADDR A:0xa013f04
y.create.l HWIO_WCSS_A_AGC_NOISE_HIST_BIN6_MSW_ADDR A:0xa013f08
y.create.l HWIO_WCSS_A_AGC_NOISE_HIST_BIN6_LSW_ADDR A:0xa013f0c
y.create.l HWIO_WCSS_A_AGC_NOISE_HIST_BIN7_MSW_ADDR A:0xa013f10
y.create.l HWIO_WCSS_A_AGC_NOISE_HIST_BIN7_LSW_ADDR A:0xa013f14
y.create.l HWIO_WCSS_A_AGC_NOISE_HIST_BIN8_MSW_ADDR A:0xa013f18
y.create.l HWIO_WCSS_A_AGC_NOISE_HIST_BIN8_LSW_ADDR A:0xa013f1c
y.create.l HWIO_WCSS_A_AGC_NOISE_HIST_BIN9_MSW_ADDR A:0xa013f20
y.create.l HWIO_WCSS_A_AGC_NOISE_HIST_BIN9_LSW_ADDR A:0xa013f24
y.create.l HWIO_WCSS_A_AGC_NOISE_HIST_BIN10_MSW_ADDR A:0xa013f28
y.create.l HWIO_WCSS_A_AGC_NOISE_HIST_BIN10_LSW_ADDR A:0xa013f2c
y.create.l HWIO_WCSS_A_AGC_NOISE_HIST_BUSY_MSW_ADDR A:0xa013f30
y.create.l HWIO_WCSS_A_AGC_NOISE_HIST_BUSY_LSW_ADDR A:0xa013f34
y.create.l HWIO_WCSS_A_AGC_WATCHDOG_MASK_ADDR A:0xa013f38
y.create.l HWIO_WCSS_A_AGC_TIMEOUT_STATE_ADDR A:0xa013f3c
y.create.l HWIO_WCSS_A_AGC_AGC_WATCHDOG_TIMEOUT_WAIT_DCO_A20_ADDR A:0xa013f40
y.create.l HWIO_WCSS_A_AGC_AGC_WATCHDOG_TIMEOUT_WAIT_DCO_A40_ADDR A:0xa013f44
y.create.l HWIO_WCSS_A_AGC_AGC_WATCHDOG_TIMEOUT_WAIT_DCO_A80_ADDR A:0xa013f48
y.create.l HWIO_WCSS_A_AGC_AGC_WATCHDOG_TIMEOUT_WAIT_DCO_B_ADDR A:0xa013f4c
y.create.l HWIO_WCSS_A_AGC_AGC_WATCHDOG_TIMEOUT_WAIT_A_ADDR A:0xa013f50
y.create.l HWIO_WCSS_A_AGC_AGC_WATCHDOG_TIMEOUT_RXA_HDR_ADDR A:0xa013f54
y.create.l HWIO_WCSS_A_AGC_AGC_WATCHDOG_TIMEOUT_HT_STS_COARSE_ADDR A:0xa013f58
y.create.l HWIO_WCSS_A_AGC_AGC_WATCHDOG_TIMEOUT_HT_STS_FINE_ADDR A:0xa013f5c
y.create.l HWIO_WCSS_A_AGC_AGC_WATCHDOG_TIMEOUT_VHT_STS_COARSE_ADDR A:0xa013f60
y.create.l HWIO_WCSS_A_AGC_AGC_WATCHDOG_TIMEOUT_VHT_STS_FINE_ADDR A:0xa013f64
y.create.l HWIO_WCSS_A_AGC_AGC_WATCHDOG_TIMEOUT_RXA_DATA_ADDR A:0xa013f68
y.create.l HWIO_WCSS_A_AGC_AGC_WATCHDOG_TIMEOUT_CAP_A_ADDR A:0xa013f6c
y.create.l HWIO_WCSS_A_AGC_AGC_WATCHDOG_TIMEOUT_TF_EST_ADDR A:0xa013f70
y.create.l HWIO_WCSS_A_AGC_AGC_WATCHDOG_TIMEOUT_WAIT_B_ADDR A:0xa013f74
y.create.l HWIO_WCSS_A_AGC_AGC_WATCHDOG_TIMEOUT_RXB_HDR_ADDR A:0xa013f78
y.create.l HWIO_WCSS_A_AGC_AGC_WATCHDOG_TIMEOUT_RXB_DATA_ADDR A:0xa013f7c
y.create.l HWIO_WCSS_A_AGC_AGC_WATCHDOG_TIMEOUT_CAP_B_ADDR A:0xa013f80
y.create.l HWIO_WCSS_A_AGC_AGC_WATCHDOG_TIMEOUT_WAIT_SIFS_ADDR A:0xa013f84
y.create.l HWIO_WCSS_A_AGC_CCA0_WATCHDOG_TIMEOUT_ADDR A:0xa013f88
y.create.l HWIO_WCSS_A_AGC_CCA1_WATCHDOG_TIMEOUT_ADDR A:0xa013f8c
y.create.l HWIO_WCSS_A_AGC_CCA2_WATCHDOG_TIMEOUT_ADDR A:0xa013f90
y.create.l HWIO_WCSS_A_AGC_CCA0_WATCHDOG_EXPIRE_COUNT_ADDR A:0xa013f94
y.create.l HWIO_WCSS_A_AGC_CCA1_WATCHDOG_EXPIRE_COUNT_ADDR A:0xa013f98
y.create.l HWIO_WCSS_A_AGC_CCA2_WATCHDOG_EXPIRE_COUNT_ADDR A:0xa013f9c
y.create.l HWIO_WCSS_A_AGC_RXFIR_CONFIG_ADDR A:0xa013fa0
y.create.l HWIO_WCSS_A_AGC_VHTSIGA_P_AID1_ADDR A:0xa013fa4
y.create.l HWIO_WCSS_A_AGC_VHTSIGA_P_AID2_ADDR A:0xa013fa8
y.create.l HWIO_WCSS_A_AGC_VHTSIGA_P_AID3_ADDR A:0xa013fac
y.create.l HWIO_WCSS_A_AGC_VHTSIGA_P_AID4_ADDR A:0xa013fb0
y.create.l HWIO_WCSS_A_AGC_VHTSIGA_P_AID5_ADDR A:0xa013fb4
y.create.l HWIO_WCSS_A_AGC_VHTSIGA_BWENCODING_ADDR A:0xa013fb8
y.create.l HWIO_WCSS_A_AGC_VHTSIGA_GID1_ADDR A:0xa013fbc
y.create.l HWIO_WCSS_A_AGC_VHTSIGA_GID2_ADDR A:0xa013fc0
y.create.l HWIO_WCSS_A_AGC_CCA_GI_DET_CFG_LGI_ADDR A:0xa013fc4
y.create.l HWIO_WCSS_A_AGC_CCA_GI_DET_CFG_SGI_ADDR A:0xa013fc8
y.create.l HWIO_WCSS_A_AGC_CCA_GI_DET_CFG1_ADDR A:0xa013fcc
y.create.l HWIO_WCSS_A_BBANA_ADC_CTRL_ADDR A:0xa014000
y.create.l HWIO_WCSS_A_BBANA_ADC_CLK_CTRL_ADDR A:0xa014004
y.create.l HWIO_WCSS_A_BBANA_ADC_REF_CTRL_ADDR A:0xa014008
y.create.l HWIO_WCSS_A_BBANA_ADC_CONV_ADJ_ADDR A:0xa01400c
y.create.l HWIO_WCSS_A_BBANA_ADC_SPARE_ADDR A:0xa014010
y.create.l HWIO_WCSS_A_BBANA_ADC_SPARE3_ADDR A:0xa014014
y.create.l HWIO_WCSS_A_BBANA_DAC_CTRL_ADDR A:0xa014018
y.create.l HWIO_WCSS_A_BBANA_DAC_BIAS_ADDR A:0xa01401c
y.create.l HWIO_WCSS_A_BBANA_DEBUG_ADDR A:0xa014020
y.create.l HWIO_WCSS_A_BBANA_DAC_CFG_ADDR A:0xa014024
y.create.l HWIO_WCSS_A_BBANA_DAC_CAL_CTRL_ADDR A:0xa014028
y.create.l HWIO_WCSS_A_BBANA_DAC_CAL_CFG_ADDR A:0xa01402c
y.create.l HWIO_WCSS_A_BBANA_DAC_CAL_STATUS_ADDR A:0xa014030
y.create.l HWIO_WCSS_A_BMU_CONTROL_ADDR A:0xa080000
y.create.l HWIO_WCSS_A_BMU_ERR_INTR_STATUS_ADDR A:0xa080004
y.create.l HWIO_WCSS_A_BMU_ERR_INTR_ENABLE_ADDR A:0xa080008
y.create.l HWIO_WCSS_A_BMU_ERR_INT_ADDR_ADDR A:0xa08000c
y.create.l HWIO_WCSS_A_BMU_ERR_INT_WDATA_ADDR A:0xa080010
y.create.l HWIO_WCSS_A_BMU_BD_PDU_THRESHOLD0_ADDR A:0xa080014
y.create.l HWIO_WCSS_A_BMU_BD_PDU_THRESHOLD1_ADDR A:0xa080018
y.create.l HWIO_WCSS_A_BMU_BD_PDU_THRESHOLD2_ADDR A:0xa08001c
y.create.l HWIO_WCSS_A_BMU_BD_PDU_THRESHOLD3_ADDR A:0xa080020
y.create.l HWIO_WCSS_A_BMU_BD_PDU_THRESHOLD4_ADDR A:0xa080024
y.create.l HWIO_WCSS_A_BMU_BD_PDU_THRESHOLD5_ADDR A:0xa080028
y.create.l HWIO_WCSS_A_BMU_BD_PDU_THRESHOLD6_ADDR A:0xa08002c
y.create.l HWIO_WCSS_A_BMU_BD_PDU_THRESHOLD7_ADDR A:0xa080030
y.create.l HWIO_WCSS_A_BMU_BD_PDU_THRESHOLD8_ADDR A:0xa080034
y.create.l HWIO_WCSS_A_BMU_BD_PDU_THRESHOLD9_ADDR A:0xa080038
y.create.l HWIO_WCSS_A_BMU_BD_PDU_THRESHOLD10_ADDR A:0xa08003c
y.create.l HWIO_WCSS_A_BMU_WQ_ENABLE_ADDR A:0xa08006c
y.create.l HWIO_WCSS_A_BMU_DPU_WQ_ASSIGNMENT_ADDR A:0xa080070
y.create.l HWIO_WCSS_A_BMU_TEST_CTRL_ADDR A:0xa080074
y.create.l HWIO_WCSS_A_BMU_TEST_OUT_LOW_ADDR A:0xa080078
y.create.l HWIO_WCSS_A_BMU_TEST_OUT_HIGH_ADDR A:0xa08007c
y.create.l HWIO_WCSS_A_BMU_GAS_CONFIGURATION_ADDR A:0xa080080
y.create.l HWIO_WCSS_A_BMU_AVAILABLE_BD_PDU_AFTER_RSV_ADDR A:0xa080084
y.create.l HWIO_WCSS_A_BMU_CONTROL2_ADDR A:0xa080088
y.create.l HWIO_WCSS_A_BMU_DISABLE_WQ_DA_ADDR A:0xa08008c
y.create.l HWIO_WCSS_A_BMU_DISABLE_BD_PDU_AVAIL_ADDR A:0xa080090
y.create.l HWIO_WCSS_A_BMU_LAST_FOUR_POP_TRACE_CONTROL_ADDR A:0xa080094
y.create.l HWIO_WCSS_A_BMU_POP_CMD_TRACE_BD_INDEX0_ADDR A:0xa080098
y.create.l HWIO_WCSS_A_BMU_POP_CMD_TRACE_BD_INDEX1_ADDR A:0xa08009c
y.create.l HWIO_WCSS_A_BMU_POP_CMD_TRACE_BD_INDEX2_ADDR A:0xa0800a0
y.create.l HWIO_WCSS_A_BMU_POP_CMD_TRACE_BD_INDEX3_ADDR A:0xa0800a4
y.create.l HWIO_WCSS_A_BMU_BMU_INTERNAL_MEM_TRACE_ADDR_ADDR A:0xa0800ac
y.create.l HWIO_WCSS_A_BMU_RELEASE_ERROR_DETAILS_ADDR A:0xa0800b0
y.create.l HWIO_WCSS_A_BMU_RELEASE_ERROR_DETAILS_LOW_ADDR A:0xa0800b4
y.create.l HWIO_WCSS_A_BMU_RELEASE_ERROR_DETAILS_HIGH_ADDR A:0xa0800b8
y.create.l HWIO_WCSS_A_BMU_RELEASE_FIFO_ENTRIES_ADDR A:0xa0800bc
y.create.l HWIO_WCSS_A_BMU_LAST_BD_PREFETCH_HEAD_ADDR A:0xa0800c0
y.create.l HWIO_WCSS_A_BMU_BD_PREFETCH_HEAD_BD_LINK_ADDR A:0xa0800c4
y.create.l HWIO_WCSS_A_BMU_BMU_PUSH_INTEGRITY_ERR_BD_INDEX_ADDR A:0xa0800c8
y.create.l HWIO_WCSS_A_BMU_BMU_WATCHDOG_TIMEOUT_TIME_ADDR A:0xa0800cc
y.create.l HWIO_WCSS_A_BMU_BMU_SM_STATES_ON_ERROR_LOW_ADDR A:0xa0800d0
y.create.l HWIO_WCSS_A_BMU_BMU_SM_STATES_ON_ERROR_HIGH_ADDR A:0xa0800d4
y.create.l HWIO_WCSS_A_BMU_BMU_PREFETCH_ERROR_DETAILS_ADDR A:0xa0800d8
y.create.l HWIO_WCSS_A_BMU_CONTROL3_ADDR A:0xa0800dc
y.create.l HWIO_WCSS_A_BMU_CONTROL4_ADDR A:0xa0800e0
y.create.l HWIO_WCSS_A_BMU_DPU_RSV_STATUS_ADDR A:0xa0800e4
y.create.l HWIO_WCSS_A_BMU_RECEIVE_DEBUG_CONTROL_ADDR A:0xa0800e8
y.create.l HWIO_WCSS_A_BMU_BMU_SPARE_REG_ADDR A:0xa0800ec
y.create.l HWIO_WCSS_A_BMU_BTQM_CONTROL1_ADDR A:0xa0800f0
y.create.l HWIO_WCSS_A_BMU_BTQM_CONTROL2_ADDR A:0xa0800f4
y.create.l HWIO_WCSS_A_BMU_BTQM_STATUS_ADDR A:0xa0800f8
y.create.l HWIO_WCSS_A_BMU_BTQM_STA_ENABLE_DISABLE_CONTROL_ADDR A:0xa0800fc
y.create.l HWIO_WCSS_A_BMU_TRANSMIT_QUEUE_ACCESS_CONTROL1_ADDR A:0xa080100
y.create.l HWIO_WCSS_A_BMU_TRANSMIT_QUEUE_ACCESS_CONTROL2_ADDR A:0xa080104
y.create.l HWIO_WCSS_A_BMU_TRANSMIT_QUEUE_ACCESS_CONTROL3_ADDR A:0xa080108
y.create.l HWIO_WCSS_A_BMU_TRANSMIT_QUEUE_ACCESS_CONTROL4_ADDR A:0xa08010c
y.create.l HWIO_WCSS_A_BMU_TRANSMIT_QUEUE_ACCESS_CONTROL5_ADDR A:0xa080110
y.create.l HWIO_WCSS_A_BMU_TRANSMIT_QUEUE_ACCESS_CONTROL6_ADDR A:0xa080114
y.create.l HWIO_WCSS_A_BMU_BD_INDEX_INFO_ACCESS_CONTROL1_ADDR A:0xa080118
y.create.l HWIO_WCSS_A_BMU_BD_INDEX_INFO_ACCESS_CONTROL2_ADDR A:0xa08011c
y.create.l HWIO_WCSS_A_BMU_BD_INDEX_INFO_ACCESS_CONTROL3_ADDR A:0xa080120
y.create.l HWIO_WCSS_A_BMU_BD_INDEX_INFO_ACCESS_CONTROL4_ADDR A:0xa080124
y.create.l HWIO_WCSS_A_BMU_BD_INDEX_INFO_ACCESS_CONTROL5_ADDR A:0xa080128
y.create.l HWIO_WCSS_A_BMU_BD_INDEX_INFO_ACCESS_CONTROL6_ADDR A:0xa08012c
y.create.l HWIO_WCSS_A_BMU_BD_INDEX_INFO_ACCESS_CONTROL7_ADDR A:0xa080130
y.create.l HWIO_WCSS_A_BMU_BAR_AND_FRAME_DROP_CONTROL_ADDR A:0xa080134
y.create.l HWIO_WCSS_A_BMU_TX_QUEUE_STAID_QUEUEID_CONFIG_ADDR A:0xa080138
y.create.l HWIO_WCSS_A_BMU_ENHANCED_TRACING_CONTROL1_ADDR A:0xa08013c
y.create.l HWIO_WCSS_A_BMU_BTQM_QUEUE_INFO_BASE_ADDR_ADDR A:0xa080140
y.create.l HWIO_WCSS_A_BMU_QOS_QUEUEID_MAPPING1_ADDR A:0xa080144
y.create.l HWIO_WCSS_A_BMU_QOS_QUEUEID_MAPPING2_ADDR A:0xa080148
y.create.l HWIO_WCSS_A_BMU_QOS_QUEUEID_MAPPING3_ADDR A:0xa08014c
y.create.l HWIO_WCSS_A_BMU_QUEUEID_BO_MAPPING1_ADDR A:0xa080154
y.create.l HWIO_WCSS_A_BMU_QUEUEID_BO_MAPPING2_ADDR A:0xa080158
y.create.l HWIO_WCSS_A_BMU_FAST_TRACE_READING_CONTROL_ADDR A:0xa080160
y.create.l HWIO_WCSS_A_BMU_FAST_TRACE_READING_DATA0_ADDR A:0xa080164
y.create.l HWIO_WCSS_A_BMU_FAST_TRACE_READING_DATA1_ADDR A:0xa080168
y.create.l HWIO_WCSS_A_BMU_FAST_TRACE_READING_DATA2_ADDR A:0xa08016c
y.create.l HWIO_WCSS_A_BMU_FAST_BD_LINK_SETUP_CONTROL_ADDR A:0xa080170
y.create.l HWIO_WCSS_A_BMU_STA_CONFIG_STATUS1_ADDR A:0xa080174
y.create.l HWIO_WCSS_A_BMU_STA_CONFIG_STATUS2_ADDR A:0xa080178
y.create.l HWIO_WCSS_A_BMU_STA_CONFIG_STATUS3_ADDR A:0xa08017c
y.create.l HWIO_WCSS_A_BMU_STA_CONFIG_STATUS4_ADDR A:0xa080180
y.create.l HWIO_WCSS_A_BMU_BTQM_ERR_STATUS_ADDR A:0xa080184
y.create.l HWIO_WCSS_A_BMU_BTQM_ERR_ENABLE_ADDR A:0xa080188
y.create.l HWIO_WCSS_A_BMU_BTQM_ERR_STATE_ADDR A:0xa08018c
y.create.l HWIO_WCSS_A_BMU_BTQM_ERR_STATE2_ADDR A:0xa080190
y.create.l HWIO_WCSS_A_BMU_BTQM_TPE_INT_STATS_ADDR A:0xa080194
y.create.l HWIO_WCSS_A_BMU_RETRY_LIMIT_DROP_CNT_ADDR A:0xa0801b4
y.create.l HWIO_WCSS_A_BMU_TPE_DROP_CNT_ADDR A:0xa0801b8
y.create.l HWIO_WCSS_A_BMU_BA_HANDLER_ACKED_DROP_CNT_ADDR A:0xa0801bc
y.create.l HWIO_WCSS_A_BMU_BA_HANDLER_WINDOW_MOVED_DROP_CNT_ADDR A:0xa0801c0
y.create.l HWIO_WCSS_A_BMU_GET_INFO_CNT_ADDR A:0xa0801c4
y.create.l HWIO_WCSS_A_BMU_GET_BD_INDEX_CNT_ADDR A:0xa0801c8
y.create.l HWIO_WCSS_A_BMU_PWR_SAVE_STA_CNT_ADDR A:0xa0801cc
y.create.l HWIO_WCSS_A_BMU_BTQM_FRAME_CNT_ADDR A:0xa0801d0
y.create.l HWIO_WCSS_A_BMU_BTQM_TIMEOUT_CHECK_CTRL_ADDR A:0xa0801d4
y.create.l HWIO_WCSS_A_BMU_PWR_STATE_CHANGE_INT_CONTROL_ADDR A:0xa0801d8
y.create.l HWIO_WCSS_A_BMU_BTQM_INTERRUPT_STATUS_ADDR A:0xa0801dc
y.create.l HWIO_WCSS_A_BMU_BTQM_INTERRUPT_ENABLE_ADDR A:0xa0801e0
y.create.l HWIO_WCSS_A_BMU_PWR_SAVE_DROP_CTRL_ADDR A:0xa0801e4
y.create.l HWIO_WCSS_A_BMU_PWR_SAVE_DROP_INT_CONTROL_ADDR A:0xa0801e8
y.create.l HWIO_WCSS_A_BMU_BMU_BACKUP_CONTROL_ADDR A:0xa0801ec
y.create.l HWIO_WCSS_A_BMU_BMU_QUEUE_DELAY_ACCESS_CONTROL_ADDR A:0xa0801f0
y.create.l HWIO_WCSS_A_BMU_QUEUE_TRANSMIT_DELAY_VALUE_ADDR A:0xa0801f4
y.create.l HWIO_WCSS_A_BMU_DXE_RX_WQ_INDEX_ADDR A:0xa0801f8
y.create.l HWIO_WCSS_A_BMU_BMU_SIF_DATA_LENGTH_ADDR A:0xa0801fc
y.create.l HWIO_WCSS_A_BMU_SW_BMU_DXE_DATA_LENGTH_ADDR A:0xa080200
y.create.l HWIO_WCSS_A_BMU_BTQM_PACKET_MEMORY_UNIT_SIZE_ADDR A:0xa080208
y.create.l HWIO_WCSS_A_BMU_SW_ACCESS_DEBUG_STATUS_ADDR A:0xa08020c
y.create.l HWIO_WCSS_A_BMU_BTQM_TX_THRESHOLD_ADDR A:0xa080210
y.create.l HWIO_WCSS_A_BMU_BTQM_STAID_3_TO_0_MEM_STATUS_ADDR A:0xa080214
y.create.l HWIO_WCSS_A_BMU_BTQM_STAID_7_TO_4_MEM_STATUS_ADDR A:0xa080218
y.create.l HWIO_WCSS_A_BMU_BTQM_PKT_MEMORY_STATUS_ADDR A:0xa08021c
y.create.l HWIO_WCSS_A_BMU_HP_RX_MEMORY_UPPER_LIMIT_ADDR A:0xa080220
y.create.l HWIO_WCSS_A_BMU_LP_RX_MEMORY_UPPER_LIMIT_ADDR A:0xa080224
y.create.l HWIO_WCSS_A_BMU_BTQM_STAID_1_TO_0_MEM_THRESHOLD_ADDR A:0xa080228
y.create.l HWIO_WCSS_A_BMU_BTQM_STAID_3_TO_2_MEM_THRESHOLD_ADDR A:0xa08022c
y.create.l HWIO_WCSS_A_BMU_BTQM_STAID_5_TO_4_MEM_THRESHOLD_ADDR A:0xa080230
y.create.l HWIO_WCSS_A_BMU_BTQM_STAID_7_TO_6_MEM_THRESHOLD_ADDR A:0xa080234
y.create.l HWIO_WCSS_A_BMU_BTQM_STAID_15_TO_0_MEM_USAGE_STATUS_ADDR A:0xa080238
y.create.l HWIO_WCSS_A_BMU_POLL_STATUS_TIMER_THRESHOLD_ADDR A:0xa08023c
y.create.l HWIO_WCSS_A_BMU_BMU_IDLE_BD_PDU_STATUS_ADDR A:0xa080240
y.create.l HWIO_WCSS_A_BMU_BTQM_STAID_11_TO_8_MEM_STATUS_ADDR A:0xa080244
y.create.l HWIO_WCSS_A_BMU_BTQM_STAID_15_TO_12_MEM_STATUS_ADDR A:0xa080248
y.create.l HWIO_WCSS_A_BMU_BTQM_STAID_9_TO_8_MEM_THRESHOLD_ADDR A:0xa08024c
y.create.l HWIO_WCSS_A_BMU_BTQM_STAID_11_TO_10_MEM_THRESHOLD_ADDR A:0xa080250
y.create.l HWIO_WCSS_A_BMU_BTQM_STAID_13_TO_12_MEM_THRESHOLD_ADDR A:0xa080254
y.create.l HWIO_WCSS_A_BMU_BTQM_STAID_15_TO_14_MEM_THRESHOLD_ADDR A:0xa080258
y.create.l HWIO_WCSS_A_BMU_BMU_PKT_MEMORY_CONFIG_MODE_ADDR A:0xa08025c
y.create.l HWIO_WCSS_A_BMU_AVAILABLE_BD_PDU_AFTER_RSV_IN_LOCAL_MEM_ADDR A:0xa080260
y.create.l HWIO_WCSS_A_BMU_BLOCK_DPU_RX_THRESHOLD_ADDR A:0xa080264
y.create.l HWIO_WCSS_A_BMU_ADU_RX_LOW_THRESHOLD_ADDR A:0xa080268
y.create.l HWIO_WCSS_A_BMU_DXE_TX_LOW_THRESHOLD_ADDR A:0xa08026c
y.create.l HWIO_WCSS_A_BMU_DXE_RX_DA_SELECTION_ADDR A:0xa080270
y.create.l HWIO_WCSS_A_BTCF_BTCF_CONFIG_ADDR A:0xa014800
y.create.l HWIO_WCSS_A_BTCF_BTCF_DET_RATIO_ADDR A:0xa014804
y.create.l HWIO_WCSS_A_BTCF_BTCF_DET_DSHIFT_ADDR A:0xa014808
y.create.l HWIO_WCSS_A_BTCF_BTCFMIN_ADDR A:0xa01480c
y.create.l HWIO_WCSS_A_BTCF_PWRMIN_ADDR A:0xa014810
y.create.l HWIO_WCSS_A_BTCF_OFFSETMIN_ADDR A:0xa014814
y.create.l HWIO_WCSS_A_CAHB_CAHB_RXP_PL_ADDR A:0xa082c00
y.create.l HWIO_WCSS_A_CAHB_CAHB_TPE_PL_ADDR A:0xa082c04
y.create.l HWIO_WCSS_A_CAHB_CAHB_RPE_PL_ADDR A:0xa082c08
y.create.l HWIO_WCSS_A_CAHB_CAHB_RPEM_PL_ADDR A:0xa082c0c
y.create.l HWIO_WCSS_A_CAHB_CAHB_DPU_PL_ADDR A:0xa082c10
y.create.l HWIO_WCSS_A_CAHB_CAHB_ADU_PL_ADDR A:0xa082c14
y.create.l HWIO_WCSS_A_CAHB_CAHB_CBR_PL_ADDR A:0xa082c18
y.create.l HWIO_WCSS_A_CAHB_CAHB_CSU_PL_ADDR A:0xa082c1c
y.create.l HWIO_WCSS_A_CAHB_CAHB_DFLT_MST_ADDR A:0xa082c48
y.create.l HWIO_WCSS_A_CAHB_CAHB_VERSION_ADDR A:0xa082c90
y.create.l HWIO_WCSS_A_CAL_CALMODE_ADDR A:0xa008000
y.create.l HWIO_WCSS_A_CAL_MEASURE_ADDR A:0xa008004
y.create.l HWIO_WCSS_A_CAL_CHAIN_SEL_ADDR A:0xa008008
y.create.l HWIO_WCSS_A_CAL_LENGTH_INIT_ADDR A:0xa00800c
y.create.l HWIO_WCSS_A_CAL_LENGTH_RSA_ADDR A:0xa008010
y.create.l HWIO_WCSS_A_CAL_LENGTH_RSB_ADDR A:0xa008014
y.create.l HWIO_WCSS_A_CAL_PIE_FFT_ADDR A:0xa008018
y.create.l HWIO_WCSS_A_CAL_DCO_THRESHOLD_ADDR A:0xa00801c
y.create.l HWIO_WCSS_A_CAL_DCTIMER1_ADDR A:0xa008020
y.create.l HWIO_WCSS_A_CAL_DCTIMER2_ADDR A:0xa008024
y.create.l HWIO_WCSS_A_CAL_DCOFFSET_ADDR A:0xa008028
y.create.l HWIO_WCSS_A_CAL_PWRDCOFFSET_ADDR A:0xa00802c
y.create.l HWIO_WCSS_A_CAL_CLR_DCOFFSET_ADDR A:0xa008030
y.create.l HWIO_WCSS_A_CAL_CHN0_DCO_OVR_ADDR A:0xa008034
y.create.l HWIO_WCSS_A_CAL_STATUS_ADDR A:0xa008038
y.create.l HWIO_WCSS_A_CAL_OVERRIDE_ADDR A:0xa00803c
y.create.l HWIO_WCSS_A_CAL_CORR_ENABLE_ADDR A:0xa008040
y.create.l HWIO_WCSS_A_CAL_AIEST_ADDR A:0xa008044
y.create.l HWIO_WCSS_A_CAL_IQ_CORR_MODE_ADDR A:0xa008048
y.create.l HWIO_WCSS_A_CAL_DEBUG_OUTPUT_EN_MASK_ADDR A:0xa00804c
y.create.l HWIO_WCSS_A_CAL_FORCE_TR_SWITCH_ADDR A:0xa008050
y.create.l HWIO_WCSS_A_CAL_AIEST_DISABLE_ADDR A:0xa008054
y.create.l HWIO_WCSS_A_CAL_BARAM_ACCESS_ADDR A:0xa008058
y.create.l HWIO_WCSS_A_CAL_BARAM0_0_ADDR A:0xa008800
y.create.l HWIO_WCSS_A_CAL_BARAM1_0_ADDR A:0xa008808
y.create.l HWIO_WCSS_A_CAL_BARAM2_0_ADDR A:0xa008810
y.create.l HWIO_WCSS_A_CAL_BARAM3_0_ADDR A:0xa008818
y.create.l HWIO_WCSS_A_CAL_BARAM4_0_ADDR A:0xa008820
y.create.l HWIO_WCSS_A_CAL_BARAM5_0_ADDR A:0xa008828
y.create.l HWIO_WCSS_A_CAL_BARAM6_0_ADDR A:0xa008830
y.create.l HWIO_WCSS_A_CAL_BARAM7_0_ADDR A:0xa008838
y.create.l HWIO_WCSS_A_CAL_BARAM8_0_ADDR A:0xa008840
y.create.l HWIO_WCSS_A_CAL_BARAM9_0_ADDR A:0xa008848
y.create.l HWIO_WCSS_A_CAL_BARAM0_1_ADDR A:0xa008804
y.create.l HWIO_WCSS_A_CAL_BARAM1_1_ADDR A:0xa00880c
y.create.l HWIO_WCSS_A_CAL_BARAM2_1_ADDR A:0xa008814
y.create.l HWIO_WCSS_A_CAL_BARAM3_1_ADDR A:0xa00881c
y.create.l HWIO_WCSS_A_CAL_BARAM4_1_ADDR A:0xa008824
y.create.l HWIO_WCSS_A_CAL_BARAM5_1_ADDR A:0xa00882c
y.create.l HWIO_WCSS_A_CAL_BARAM6_1_ADDR A:0xa008834
y.create.l HWIO_WCSS_A_CAL_BARAM7_1_ADDR A:0xa00883c
y.create.l HWIO_WCSS_A_CAL_BARAM8_1_ADDR A:0xa008844
y.create.l HWIO_WCSS_A_CAL_BARAM9_1_ADDR A:0xa00884c
y.create.l HWIO_WCSS_A_CAL_IQ_CORR_COEFF_MEM0_0_ADDR A:0xa009000
y.create.l HWIO_WCSS_A_CAL_IQ_CORR_COEFF_MEM1_0_ADDR A:0xa009020
y.create.l HWIO_WCSS_A_CAL_IQ_CORR_COEFF_MEM2_0_ADDR A:0xa009040
y.create.l HWIO_WCSS_A_CAL_IQ_CORR_COEFF_MEM3_0_ADDR A:0xa009060
y.create.l HWIO_WCSS_A_CAL_IQ_CORR_COEFF_MEM4_0_ADDR A:0xa009080
y.create.l HWIO_WCSS_A_CAL_IQ_CORR_COEFF_MEM5_0_ADDR A:0xa0090a0
y.create.l HWIO_WCSS_A_CAL_IQ_CORR_COEFF_MEM6_0_ADDR A:0xa0090c0
y.create.l HWIO_WCSS_A_CAL_IQ_CORR_COEFF_MEM7_0_ADDR A:0xa0090e0
y.create.l HWIO_WCSS_A_CAL_IQ_CORR_COEFF_MEM8_0_ADDR A:0xa009100
y.create.l HWIO_WCSS_A_CAL_IQ_CORR_COEFF_MEM9_0_ADDR A:0xa009120
y.create.l HWIO_WCSS_A_CAL_IQ_CORR_COEFF_MEM0_1_ADDR A:0xa009004
y.create.l HWIO_WCSS_A_CAL_IQ_CORR_COEFF_MEM1_1_ADDR A:0xa009024
y.create.l HWIO_WCSS_A_CAL_IQ_CORR_COEFF_MEM2_1_ADDR A:0xa009044
y.create.l HWIO_WCSS_A_CAL_IQ_CORR_COEFF_MEM3_1_ADDR A:0xa009064
y.create.l HWIO_WCSS_A_CAL_IQ_CORR_COEFF_MEM4_1_ADDR A:0xa009084
y.create.l HWIO_WCSS_A_CAL_IQ_CORR_COEFF_MEM5_1_ADDR A:0xa0090a4
y.create.l HWIO_WCSS_A_CAL_IQ_CORR_COEFF_MEM6_1_ADDR A:0xa0090c4
y.create.l HWIO_WCSS_A_CAL_IQ_CORR_COEFF_MEM7_1_ADDR A:0xa0090e4
y.create.l HWIO_WCSS_A_CAL_IQ_CORR_COEFF_MEM8_1_ADDR A:0xa009104
y.create.l HWIO_WCSS_A_CAL_IQ_CORR_COEFF_MEM9_1_ADDR A:0xa009124
y.create.l HWIO_WCSS_A_CAL_IQ_CORR_COEFF_MEM0_2_ADDR A:0xa009008
y.create.l HWIO_WCSS_A_CAL_IQ_CORR_COEFF_MEM1_2_ADDR A:0xa009028
y.create.l HWIO_WCSS_A_CAL_IQ_CORR_COEFF_MEM2_2_ADDR A:0xa009048
y.create.l HWIO_WCSS_A_CAL_IQ_CORR_COEFF_MEM3_2_ADDR A:0xa009068
y.create.l HWIO_WCSS_A_CAL_IQ_CORR_COEFF_MEM4_2_ADDR A:0xa009088
y.create.l HWIO_WCSS_A_CAL_IQ_CORR_COEFF_MEM5_2_ADDR A:0xa0090a8
y.create.l HWIO_WCSS_A_CAL_IQ_CORR_COEFF_MEM6_2_ADDR A:0xa0090c8
y.create.l HWIO_WCSS_A_CAL_IQ_CORR_COEFF_MEM7_2_ADDR A:0xa0090e8
y.create.l HWIO_WCSS_A_CAL_IQ_CORR_COEFF_MEM8_2_ADDR A:0xa009108
y.create.l HWIO_WCSS_A_CAL_IQ_CORR_COEFF_MEM9_2_ADDR A:0xa009128
y.create.l HWIO_WCSS_A_CAL_IQ_CORR_COEFF_MEM0_3_ADDR A:0xa00900c
y.create.l HWIO_WCSS_A_CAL_IQ_CORR_COEFF_MEM1_3_ADDR A:0xa00902c
y.create.l HWIO_WCSS_A_CAL_IQ_CORR_COEFF_MEM2_3_ADDR A:0xa00904c
y.create.l HWIO_WCSS_A_CAL_IQ_CORR_COEFF_MEM3_3_ADDR A:0xa00906c
y.create.l HWIO_WCSS_A_CAL_IQ_CORR_COEFF_MEM4_3_ADDR A:0xa00908c
y.create.l HWIO_WCSS_A_CAL_IQ_CORR_COEFF_MEM5_3_ADDR A:0xa0090ac
y.create.l HWIO_WCSS_A_CAL_IQ_CORR_COEFF_MEM6_3_ADDR A:0xa0090cc
y.create.l HWIO_WCSS_A_CAL_IQ_CORR_COEFF_MEM7_3_ADDR A:0xa0090ec
y.create.l HWIO_WCSS_A_CAL_IQ_CORR_COEFF_MEM8_3_ADDR A:0xa00910c
y.create.l HWIO_WCSS_A_CAL_IQ_CORR_COEFF_MEM9_3_ADDR A:0xa00912c
y.create.l HWIO_WCSS_A_CAL_IQ_CORR_COEFF_MEM0_4_ADDR A:0xa009010
y.create.l HWIO_WCSS_A_CAL_IQ_CORR_COEFF_MEM1_4_ADDR A:0xa009030
y.create.l HWIO_WCSS_A_CAL_IQ_CORR_COEFF_MEM2_4_ADDR A:0xa009050
y.create.l HWIO_WCSS_A_CAL_IQ_CORR_COEFF_MEM3_4_ADDR A:0xa009070
y.create.l HWIO_WCSS_A_CAL_IQ_CORR_COEFF_MEM4_4_ADDR A:0xa009090
y.create.l HWIO_WCSS_A_CAL_IQ_CORR_COEFF_MEM5_4_ADDR A:0xa0090b0
y.create.l HWIO_WCSS_A_CAL_IQ_CORR_COEFF_MEM6_4_ADDR A:0xa0090d0
y.create.l HWIO_WCSS_A_CAL_IQ_CORR_COEFF_MEM7_4_ADDR A:0xa0090f0
y.create.l HWIO_WCSS_A_CAL_IQ_CORR_COEFF_MEM8_4_ADDR A:0xa009110
y.create.l HWIO_WCSS_A_CAL_IQ_CORR_COEFF_MEM9_4_ADDR A:0xa009130
y.create.l HWIO_WCSS_A_CAL_IQ_CORR_COEFF_MEM0_5_ADDR A:0xa009014
y.create.l HWIO_WCSS_A_CAL_IQ_CORR_COEFF_MEM1_5_ADDR A:0xa009034
y.create.l HWIO_WCSS_A_CAL_IQ_CORR_COEFF_MEM2_5_ADDR A:0xa009054
y.create.l HWIO_WCSS_A_CAL_IQ_CORR_COEFF_MEM3_5_ADDR A:0xa009074
y.create.l HWIO_WCSS_A_CAL_IQ_CORR_COEFF_MEM4_5_ADDR A:0xa009094
y.create.l HWIO_WCSS_A_CAL_IQ_CORR_COEFF_MEM5_5_ADDR A:0xa0090b4
y.create.l HWIO_WCSS_A_CAL_IQ_CORR_COEFF_MEM6_5_ADDR A:0xa0090d4
y.create.l HWIO_WCSS_A_CAL_IQ_CORR_COEFF_MEM7_5_ADDR A:0xa0090f4
y.create.l HWIO_WCSS_A_CAL_IQ_CORR_COEFF_MEM8_5_ADDR A:0xa009114
y.create.l HWIO_WCSS_A_CAL_IQ_CORR_COEFF_MEM9_5_ADDR A:0xa009134
y.create.l HWIO_WCSS_A_CCU_CCU_ENABLE_CLK_ADDR A:0xa204000
y.create.l HWIO_WCSS_A_CCU_CCU_DISABLE_CLK_GATING_ADDR A:0xa204004
y.create.l HWIO_WCSS_A_CCU_CCU_GCU_DISABLE_CLK_GATING_ADDR A:0xa204008
y.create.l HWIO_WCSS_A_CCU_CCU_CRCM_CONTROL_ADDR A:0xa20400c
y.create.l HWIO_WCSS_A_CCU_CCU_SOFT_RESET_ADDR A:0xa204010
y.create.l HWIO_WCSS_A_CCU_CCU_SPARE_TEST_CTL_ADDR A:0xa2050f4
y.create.l HWIO_WCSS_A_CCU_CCU_SPARE_INT_CTL_ADDR A:0xa2050f8
y.create.l HWIO_WCSS_A_CCU_CCU_ROM_BASE_ADDR1_ADDR A:0xa205000
y.create.l HWIO_WCSS_A_CCU_CCU_ROM_BASE_ADDR2_ADDR A:0xa205004
y.create.l HWIO_WCSS_A_CCU_CCU_ROM_START_ADDR1_ADDR A:0xa205008
y.create.l HWIO_WCSS_A_CCU_CCU_ROM_START_ADDR2_ADDR A:0xa20500c
y.create.l HWIO_WCSS_A_CCU_CCU_ROM_START_ADDR3_ADDR A:0xa205010
y.create.l HWIO_WCSS_A_CCU_CCU_ROM_START_ADDR4_ADDR A:0xa205014
y.create.l HWIO_WCSS_A_CCU_CCU_ROM_END_ADDR1_ADDR A:0xa205018
y.create.l HWIO_WCSS_A_CCU_CCU_ROM_END_ADDR2_ADDR A:0xa20501c
y.create.l HWIO_WCSS_A_CCU_CCU_ROM_END_ADDR3_ADDR A:0xa205020
y.create.l HWIO_WCSS_A_CCU_CCU_ROM_END_ADDR4_ADDR A:0xa205024
y.create.l HWIO_WCSS_A_CCU_CCU_TESTBUS_CONTROL_ADDR A:0xa20502c
y.create.l HWIO_WCSS_A_CCU_CCU_TESTBUS_LOWER_ADDR A:0xa205030
y.create.l HWIO_WCSS_A_CCU_CCU_TESTBUS_UPPER_ADDR A:0xa205034
y.create.l HWIO_WCSS_A_CCU_CCU_RRI_SW_REG_REINIT_ADDR A:0xa205038
y.create.l HWIO_WCSS_A_CCU_CCU_RRI_SW_REG_REINIT_ADDR_ADDR A:0xa20503c
y.create.l HWIO_WCSS_A_CCU_CCU_RRI_POLL_CMD_ERR_ADDR_ADDR A:0xa205040
y.create.l HWIO_WCSS_A_CCU_CCU_RRI_MISC_CFG_ADDR A:0xa205044
y.create.l HWIO_WCSS_A_CCU_CCU_MISC_CTL_ADDR A:0xa20504c
y.create.l HWIO_WCSS_A_CCU_CCU_CCPU_STALL_COUNT_ADDR A:0xa205050
y.create.l HWIO_WCSS_A_CCU_CCU_CCPU_ACTIVE_COUNT_ADDR A:0xa205054
y.create.l HWIO_WCSS_A_CCU_CCU_CCPU_INVALID_ADDR_ADDR A:0xa205058
y.create.l HWIO_WCSS_A_CCU_CCU_CCPU_LAST_ADDR0_ADDR A:0xa20505c
y.create.l HWIO_WCSS_A_CCU_CCU_CCPU_LAST_ADDR1_ADDR A:0xa205060
y.create.l HWIO_WCSS_A_CCU_CCU_CCPU_LAST_ADDR2_ADDR A:0xa205064
y.create.l HWIO_WCSS_A_CCU_CCU_A2AB_ERR_ADDR_ADDR A:0xa205068
y.create.l HWIO_WCSS_A_CCU_CCU_A2AB_CTL_ADDR A:0xa20506c
y.create.l HWIO_WCSS_A_CCU_CCU_A2AB_CFG_ADDR A:0xa205070
y.create.l HWIO_WCSS_A_CCU_CCU_WRAP_ADDR_ADDR A:0xa205074
y.create.l HWIO_WCSS_A_CCU_CCU_AOWBR_ERR_ADDR_ADDR A:0xa205078
y.create.l HWIO_WCSS_A_CCU_CCU_CCPU_TO_MSM_MB_INT_STAT_ADDR A:0xa206000
y.create.l HWIO_WCSS_A_CCU_CCU_MSM_TO_CCPU_MB_INT_STAT_ADDR A:0xa206004
y.create.l HWIO_WCSS_A_CCU_CCU_MB0_CONTROL_ADDR A:0xa206008
y.create.l HWIO_WCSS_A_CCU_CCU_MB0_CONTROL_COUNTERS_ADDR A:0xa20600c
y.create.l HWIO_WCSS_A_CCU_CCU_MB1_CONTROL_ADDR A:0xa206010
y.create.l HWIO_WCSS_A_CCU_CCU_MB1_CONTROL_COUNTERS_ADDR A:0xa206014
y.create.l HWIO_WCSS_A_CCU_CCU_MB2_CONTROL_ADDR A:0xa206018
y.create.l HWIO_WCSS_A_CCU_CCU_MB2_CONTROL_COUNTERS_ADDR A:0xa20601c
y.create.l HWIO_WCSS_A_CCU_CCU_MB3_CONTROL_ADDR A:0xa206020
y.create.l HWIO_WCSS_A_CCU_CCU_MB3_CONTROL_COUNTERS_ADDR A:0xa206024
y.create.l HWIO_WCSS_A_CCU_CCU_MB4_CONTROL_ADDR A:0xa206028
y.create.l HWIO_WCSS_A_CCU_CCU_MB4_CONTROL_COUNTERS_ADDR A:0xa20602c
y.create.l HWIO_WCSS_A_CCU_CCU_MB5_CONTROL_ADDR A:0xa206030
y.create.l HWIO_WCSS_A_CCU_CCU_MB5_CONTROL_COUNTERS_ADDR A:0xa206034
y.create.l HWIO_WCSS_A_CCU_CCU_MB6_CONTROL_ADDR A:0xa206038
y.create.l HWIO_WCSS_A_CCU_CCU_MB6_CONTROL_COUNTERS_ADDR A:0xa20603c
y.create.l HWIO_WCSS_A_CCU_CCU_MB7_CONTROL_ADDR A:0xa206040
y.create.l HWIO_WCSS_A_CCU_CCU_MB7_CONTROL_COUNTERS_ADDR A:0xa206044
y.create.l HWIO_WCSS_A_CCU_CCU_MUTEX0_ADDR A:0xa2060b0
y.create.l HWIO_WCSS_A_CCU_CCU_MUTEX1_ADDR A:0xa2060b4
y.create.l HWIO_WCSS_A_CCU_CCU_MUTEX2_ADDR A:0xa2060b8
y.create.l HWIO_WCSS_A_CCU_CCU_MUTEX3_ADDR A:0xa2060bc
y.create.l HWIO_WCSS_A_CCU_CCU_MUTEX4_ADDR A:0xa2060c0
y.create.l HWIO_WCSS_A_CCU_CCU_MUTEX5_ADDR A:0xa2060c4
y.create.l HWIO_WCSS_A_CCU_CCU_MUTEX6_ADDR A:0xa2060c8
y.create.l HWIO_WCSS_A_CCU_CCU_MUTEX7_ADDR A:0xa2060cc
y.create.l HWIO_WCSS_A_CCU_CCU_TRACE_CONTROL1_ADDR A:0xa20507c
y.create.l HWIO_WCSS_A_CCU_CCU_TRACE_CONTROL2_ADDR A:0xa205080
y.create.l HWIO_WCSS_A_CCU_CCU_TRC_WFT_CAPTURE_CTRL_ADDR A:0xa205084
y.create.l HWIO_WCSS_A_CCU_CCU_TRC_WFT_STATE_CTRL_ADDR A:0xa205088
y.create.l HWIO_WCSS_A_CCU_CCU_TRC_TS1_CAPTURE_CTRL_ADDR A:0xa20508c
y.create.l HWIO_WCSS_A_CCU_CCU_TRC_TS1_STATE_CTRL_ADDR A:0xa205090
y.create.l HWIO_WCSS_A_CCU_CCU_TRC_TS1_TRIGGER_MASK_ADDR A:0xa205094
y.create.l HWIO_WCSS_A_CCU_CCU_TRC_TS1_TRIGGER_VALUE_ADDR A:0xa205098
y.create.l HWIO_WCSS_A_CCU_CCU_TRC_TS2_CAPTURE_CTRL_ADDR A:0xa20509c
y.create.l HWIO_WCSS_A_CCU_CCU_TRC_TS2_STATE_CTRL_ADDR A:0xa2050a0
y.create.l HWIO_WCSS_A_CCU_CCU_TRC_TS2_TRIGGER_MASK_ADDR A:0xa2050a4
y.create.l HWIO_WCSS_A_CCU_CCU_TRC_TS2_TRIGGER_VALUE_ADDR A:0xa2050a8
y.create.l HWIO_WCSS_A_CCU_CCU_TRC_TS3_CAPTURE_CTRL_ADDR A:0xa2050ac
y.create.l HWIO_WCSS_A_CCU_CCU_TRC_TS3_STATE_CTRL_ADDR A:0xa2050b0
y.create.l HWIO_WCSS_A_CCU_CCU_TRC_TS3_TRIGGER_MASK_ADDR A:0xa2050b4
y.create.l HWIO_WCSS_A_CCU_CCU_TRC_TS3_TRIGGER_VALUE_ADDR A:0xa2050b8
y.create.l HWIO_WCSS_A_CCU_CCU_TRC_TS4_CAPTURE_CTRL_ADDR A:0xa2050bc
y.create.l HWIO_WCSS_A_CCU_CCU_TRC_TS4_STATE_CTRL_ADDR A:0xa2050c0
y.create.l HWIO_WCSS_A_CCU_CCU_TRC_TS4_TRIGGER_MASK_ADDR A:0xa2050c4
y.create.l HWIO_WCSS_A_CCU_CCU_TRC_TS4_TRIGGER_VALUE_ADDR A:0xa2050c8
y.create.l HWIO_WCSS_A_CCU_CCU_TRC_TS5_CAPTURE_CTRL_ADDR A:0xa2050cc
y.create.l HWIO_WCSS_A_CCU_CCU_TRC_TS5_STATE_CTRL_ADDR A:0xa2050d0
y.create.l HWIO_WCSS_A_CCU_CCU_TRC_TS5_TRIGGER_MASK_ADDR A:0xa2050d4
y.create.l HWIO_WCSS_A_CCU_CCU_TRC_TS5_TRIGGER_VALUE_ADDR A:0xa2050d8
y.create.l HWIO_WCSS_A_CCU_CCU_DXE_INT_SELECT_ADDR A:0xa2050dc
y.create.l HWIO_WCSS_A_CCU_CCU_DXE_INT_SELECT_STATUS_ADDR A:0xa2050e0
y.create.l HWIO_WCSS_A_CCU_CCU_ASIC_INT_ENABLE_ADDR A:0xa2050e4
y.create.l HWIO_WCSS_A_CCU_CCU_ASIC_INT_STATUS_ADDR A:0xa2050e8
y.create.l HWIO_WCSS_A_CCU_TESTMUX_CONTROL1_ADDR A:0xa2050ec
y.create.l HWIO_WCSS_A_CCU_TESTMUX_CONTROL2_ADDR A:0xa2050f0
y.create.l HWIO_WCSS_A_CCU_CCU_CCPU_DBG_STATUS_ADDR A:0xa2050fc
y.create.l HWIO_WCSS_A_CCU_CCU_TRC_STATUS_ADDR A:0xa205100
y.create.l HWIO_WCSS_A_CCU_CCU_TRC_TRIG_SAMPLE_ADDR A:0xa205104
y.create.l HWIO_WCSS_A_CCU_CCU_TRC_RD_ADDR_ADDR A:0xa205108
y.create.l HWIO_WCSS_A_CCU_SLP_CALIB_CYCLES_REG_ADDR A:0xa20510c
y.create.l HWIO_WCSS_A_CCU_SLP_CALIB_CTL_REG_ADDR A:0xa205110
y.create.l HWIO_WCSS_A_CCU_SLP_CALIB_DONE_REG_ADDR A:0xa205114
y.create.l HWIO_WCSS_A_CCU_SLP_CALIB_CNT_AHB_PER_SLP_REG_ADDR A:0xa205118
y.create.l HWIO_WCSS_A_CCU_AOWBR_TIMEOUT_ADDR_REG_ADDR A:0xa20511c
y.create.l HWIO_WCSS_A_CCU_AOWBR_ERR_TIMEOUT_FLAGS_REG_ADDR A:0xa205120
y.create.l HWIO_WCSS_A_CCU_UART_UART_RBR_ADDR A:0xa207000
y.create.l HWIO_WCSS_A_CCU_UART_UART_DLH_ADDR A:0xa207004
y.create.l HWIO_WCSS_A_CCU_UART_UART_IIR_ADDR A:0xa207008
y.create.l HWIO_WCSS_A_CCU_UART_UART_LCR_ADDR A:0xa20700c
y.create.l HWIO_WCSS_A_CCU_UART_UART_MCR_ADDR A:0xa207010
y.create.l HWIO_WCSS_A_CCU_UART_UART_LSR_ADDR A:0xa207014
y.create.l HWIO_WCSS_A_CCU_UART_UART_MSR_ADDR A:0xa207018
y.create.l HWIO_WCSS_A_CCU_UART_UART_SCRATCH_ADDR A:0xa20701c
y.create.l HWIO_WCSS_A_CCU_UART_UART_FAR_ADDR A:0xa207070
y.create.l HWIO_WCSS_A_CCU_UART_UART_USR_ADDR A:0xa20707c
y.create.l HWIO_WCSS_A_CCU_UART_UART_HTX_ADDR A:0xa2070a4
y.create.l HWIO_WCSS_A_CCU_UART_UART_DMASA_ADDR A:0xa2070a8
y.create.l HWIO_WCSS_A_CDAHB_CDAHB_RRI_PL_ADDR A:0xa100000
y.create.l HWIO_WCSS_A_CDAHB_CDAHB_FDBR_PL_ADDR A:0xa100004
y.create.l HWIO_WCSS_A_CDAHB_CDAHB_CCPU_PL_ADDR A:0xa100008
y.create.l HWIO_WCSS_A_CDAHB_CDAHB_DBR_PL_ADDR A:0xa10000c
y.create.l HWIO_WCSS_A_CDAHB_CDAHB_A2AB_PL_ADDR A:0xa100010
y.create.l HWIO_WCSS_A_CDAHB_CDAHB_DXE_PL_ADDR A:0xa100014
y.create.l HWIO_WCSS_A_CDAHB_CDAHB_DFLT_MST_ADDR A:0xa100048
y.create.l HWIO_WCSS_A_CDAHB_CDAHB_VERSION_ADDR A:0xa100090
y.create.l HWIO_WCSS_A_DAHB_DAHB_DPUW_PL_ADDR A:0xa0c0000
y.create.l HWIO_WCSS_A_DAHB_DAHB_DPUR_PL_ADDR A:0xa0c0004
y.create.l HWIO_WCSS_A_DAHB_DAHB_BMUW_PL_ADDR A:0xa0c0008
y.create.l HWIO_WCSS_A_DAHB_DAHB_BMUR_PL_ADDR A:0xa0c000c
y.create.l HWIO_WCSS_A_DAHB_DAHB_ADU_PL_ADDR A:0xa0c0010
y.create.l HWIO_WCSS_A_DAHB_DAHB_CBR_PL_ADDR A:0xa0c0014
y.create.l HWIO_WCSS_A_DAHB_DAHB_CSU_PL_ADDR A:0xa0c0018
y.create.l HWIO_WCSS_A_DAHB_DAHB_DFLT_MST_ADDR A:0xa0c0048
y.create.l HWIO_WCSS_A_DAHB_DAHB_VERSION_ADDR A:0xa0c0090
y.create.l HWIO_WCSS_A_DPU_DPU_TXPKTCOUNT_ADDR A:0xa081800
y.create.l HWIO_WCSS_A_DPU_DPU_RXPKTCOUNT_ADDR A:0xa081804
y.create.l HWIO_WCSS_A_DPU_DPU_BASE_ADDR_ADDR A:0xa08180c
y.create.l HWIO_WCSS_A_DPU_DPU_KEYBASE_ADDR_ADDR A:0xa081810
y.create.l HWIO_WCSS_A_DPU_DPU_MICKEYBASE_ADDR_ADDR A:0xa081814
y.create.l HWIO_WCSS_A_DPU_DPU_RCBASE_ADDR_ADDR A:0xa081818
y.create.l HWIO_WCSS_A_DPU_DPU_CONTROL_ADDR A:0xa08181c
y.create.l HWIO_WCSS_A_DPU_DPU_INTERRUPT_MASK_ADDR A:0xa081820
y.create.l HWIO_WCSS_A_DPU_DPU_INTERRUPT_STATUS_ADDR A:0xa081824
y.create.l HWIO_WCSS_A_DPU_DPU_BIP_MMIE_ADDR A:0xa081828
y.create.l HWIO_WCSS_A_DPU_DPU_WATCHDOG_ADDR A:0xa081848
y.create.l HWIO_WCSS_A_DPU_DPU_BD_IN_COUNTS_ADDR A:0xa08184c
y.create.l HWIO_WCSS_A_DPU_DPU_BD_OUT_COUNTS_ADDR A:0xa081850
y.create.l HWIO_WCSS_A_DPU_DPU_WQ_3_RESERVE_ADDR A:0xa081854
y.create.l HWIO_WCSS_A_DPU_DPU_WQ_5_RESERVE_ADDR A:0xa08185c
y.create.l HWIO_WCSS_A_DPU_DPU_WQ_6_RESERVE_ADDR A:0xa081860
y.create.l HWIO_WCSS_A_DPU_DPU_WQ_7_RESERVE_ADDR A:0xa081864
y.create.l HWIO_WCSS_A_DPU_DPU_ERROR_WQ_ADDR A:0xa081874
y.create.l HWIO_WCSS_A_DPU_DPU_ERROR_WQ_SELECT_ADDR A:0xa081878
y.create.l HWIO_WCSS_A_DPU_DPU_ERROR_WQ_COUNT_ADDR A:0xa08187c
y.create.l HWIO_WCSS_A_DPU_DPU_FRAG_COUNT_ADDR A:0xa081880
y.create.l HWIO_WCSS_A_DPU_DPU_DBG_TESTBUS_HI_ADDR A:0xa081884
y.create.l HWIO_WCSS_A_DPU_DPU_DBG_TESTBUS_LO_ADDR A:0xa081888
y.create.l HWIO_WCSS_A_DPU_DPU_DBG_WQ_AVAIL_ADDR A:0xa08188c
y.create.l HWIO_WCSS_A_DPU_DPU_DBG_WQ_ALLOW_ADDR A:0xa081890
y.create.l HWIO_WCSS_A_DPU_DPU_DBG_SM_STATE_ADDR A:0xa081894
y.create.l HWIO_WCSS_A_DPU_DPU_DBG_BUF_FILL_ADDR A:0xa081898
y.create.l HWIO_WCSS_A_DPU_DPU_DBG_BD_DPU_WORD0_ADDR A:0xa08189c
y.create.l HWIO_WCSS_A_DPU_DPU_DBG_BD_DPU_WORD2_ADDR A:0xa0818a0
y.create.l HWIO_WCSS_A_DPU_DPU_DBG_BD_DPU_WORD3_ADDR A:0xa0818a4
y.create.l HWIO_WCSS_A_DPU_DPU_DBG_BD_DPU_WORD4_ADDR A:0xa0818a8
y.create.l HWIO_WCSS_A_DPU_DPU_DBG_BD_DPU_WORD5_ADDR A:0xa0818ac
y.create.l HWIO_WCSS_A_DPU_DPU_DBG_DD_WORD_0_ADDR A:0xa0818d0
y.create.l HWIO_WCSS_A_DPU_DPU_DBG_DD_WORD_1_ADDR A:0xa0818d4
y.create.l HWIO_WCSS_A_DPU_DPU_DBG_DD_WORD_2_ADDR A:0xa0818d8
y.create.l HWIO_WCSS_A_DPU_DPU_DBG_DD_WORD_3_ADDR A:0xa0818dc
y.create.l HWIO_WCSS_A_DPU_DPU_DBG_DD_WORD_4_ADDR A:0xa0818e0
y.create.l HWIO_WCSS_A_DPU_DPU_WAPIMICKEYBASE_ADDR_ADDR A:0xa0818e4
y.create.l HWIO_WCSS_A_DPU_DPU_BUG_FIX_ADDR A:0xa0818e8
y.create.l HWIO_WCSS_A_DPU_DPU_AES_MASK_ADDR A:0xa0818ec
y.create.l HWIO_WCSS_A_DPU_DPU_TKIP_MASK_ADDR A:0xa0818f0
y.create.l HWIO_WCSS_A_DPU_DPU_SEQUENCE_NO_ADDR A:0xa0818f4
y.create.l HWIO_WCSS_A_DPU_DPU_ROUTING_FLAG_ADDR A:0xa0818f8
y.create.l HWIO_WCSS_A_DPU_DPU_HOST_WAKEUP_STATUS_MAGICBD_ADDR A:0xa0818fc
y.create.l HWIO_WCSS_A_DPU_DPU_WOW_CONFIG_ADDR A:0xa081900
y.create.l HWIO_WCSS_A_DPU_DPU_WOW_TIMERS_ADDR A:0xa081904
y.create.l HWIO_WCSS_A_DPU_DPU_WOW_MAGIC_PACKET_HI_ADDR A:0xa081908
y.create.l HWIO_WCSS_A_DPU_DPU_WOW_MAGIC_PACKET_LO_ADDR A:0xa08190c
y.create.l HWIO_WCSS_A_DPU_WOW_FOUND_MAGIC_COUNTER_ADDR A:0xa081910
y.create.l HWIO_WCSS_A_DPU_WOW_WAITING4MAGIC_COUNTER_ADDR A:0xa081914
y.create.l HWIO_WCSS_A_DPU_WAPI_STA_KEY_INDEX_VALUES_ADDR A:0xa081918
y.create.l HWIO_WCSS_A_DPU_WAPI_STA0_KEY_INDEXES_ADDR A:0xa081920
y.create.l HWIO_WCSS_A_DPU_WAPI_STA1_KEY_INDEXES_ADDR A:0xa081924
y.create.l HWIO_WCSS_A_DPU_WAPI_STA2_KEY_INDEXES_ADDR A:0xa081928
y.create.l HWIO_WCSS_A_DPU_WAPI_STA3_KEY_INDEXES_ADDR A:0xa08192c
y.create.l HWIO_WCSS_A_DPU_WAPI_STA4_KEY_INDEXES_ADDR A:0xa081930
y.create.l HWIO_WCSS_A_DPU_WAPI_STA5_KEY_INDEXES_ADDR A:0xa081934
y.create.l HWIO_WCSS_A_DPU_WAPI_STA6_KEY_INDEXES_ADDR A:0xa081938
y.create.l HWIO_WCSS_A_DPU_WAPI_STA7_KEY_INDEXES_ADDR A:0xa08193c
y.create.l HWIO_WCSS_A_DPU_WAPI_STA8_KEY_INDEXES_ADDR A:0xa081940
y.create.l HWIO_WCSS_A_DPU_WAPI_STA9_KEY_INDEXES_ADDR A:0xa081944
y.create.l HWIO_WCSS_A_DPU_WAPI_STA10_KEY_INDEXES_ADDR A:0xa081948
y.create.l HWIO_WCSS_A_DPU_WAPI_STA11_KEY_INDEXES_ADDR A:0xa08194c
y.create.l HWIO_WCSS_A_DPU_WAPI_STA12_KEY_INDEXES_ADDR A:0xa081950
y.create.l HWIO_WCSS_A_DPU_WAPI_STA13_KEY_INDEXES_ADDR A:0xa081954
y.create.l HWIO_WCSS_A_DPU_WAPI_STA14_KEY_INDEXES_ADDR A:0xa081958
y.create.l HWIO_WCSS_A_DPU_WAPI_STA15_KEY_INDEXES_ADDR A:0xa08195c
y.create.l HWIO_WCSS_A_DPU_WAPI_PN_CONFIG_ADDR A:0xa081964
y.create.l HWIO_WCSS_A_FDAHB_FDAHB_RXP_PL_ADDR A:0xa0c0400
y.create.l HWIO_WCSS_A_FDAHB_FDAHB_TXP_PL_ADDR A:0xa0c0404
y.create.l HWIO_WCSS_A_FDAHB_FDAHB_TPE_PL_ADDR A:0xa0c0408
y.create.l HWIO_WCSS_A_FDAHB_FDAHB_CBR_PL_ADDR A:0xa0c040c
y.create.l HWIO_WCSS_A_FDAHB_FDAHB_RPE_PL_ADDR A:0xa0c0410
y.create.l HWIO_WCSS_A_FDAHB_FDAHB_DFLT_MST_ADDR A:0xa0c0448
y.create.l HWIO_WCSS_A_FDAHB_FDAHB_VERSION_ADDR A:0xa0c0490
y.create.l HWIO_WCSS_A_FFT_FFT_RAM_00_0_ADDR A:0xa00c000
y.create.l HWIO_WCSS_A_FFT_FFT_RAM_01_0_ADDR A:0xa00c008
y.create.l HWIO_WCSS_A_FFT_FFT_RAM_02_0_ADDR A:0xa00c010
y.create.l HWIO_WCSS_A_FFT_FFT_RAM_03_0_ADDR A:0xa00c018
y.create.l HWIO_WCSS_A_FFT_FFT_RAM_04_0_ADDR A:0xa00c020
y.create.l HWIO_WCSS_A_FFT_FFT_RAM_05_0_ADDR A:0xa00c028
y.create.l HWIO_WCSS_A_FFT_FFT_RAM_06_0_ADDR A:0xa00c030
y.create.l HWIO_WCSS_A_FFT_FFT_RAM_07_0_ADDR A:0xa00c038
y.create.l HWIO_WCSS_A_FFT_FFT_RAM_08_0_ADDR A:0xa00c040
y.create.l HWIO_WCSS_A_FFT_FFT_RAM_09_0_ADDR A:0xa00c048
y.create.l HWIO_WCSS_A_FFT_FFT_RAM_00_1_ADDR A:0xa00c004
y.create.l HWIO_WCSS_A_FFT_FFT_RAM_01_1_ADDR A:0xa00c00c
y.create.l HWIO_WCSS_A_FFT_FFT_RAM_02_1_ADDR A:0xa00c014
y.create.l HWIO_WCSS_A_FFT_FFT_RAM_03_1_ADDR A:0xa00c01c
y.create.l HWIO_WCSS_A_FFT_FFT_RAM_04_1_ADDR A:0xa00c024
y.create.l HWIO_WCSS_A_FFT_FFT_RAM_05_1_ADDR A:0xa00c02c
y.create.l HWIO_WCSS_A_FFT_FFT_RAM_06_1_ADDR A:0xa00c034
y.create.l HWIO_WCSS_A_FFT_FFT_RAM_07_1_ADDR A:0xa00c03c
y.create.l HWIO_WCSS_A_FFT_FFT_RAM_08_1_ADDR A:0xa00c044
y.create.l HWIO_WCSS_A_FFT_FFT_RAM_09_1_ADDR A:0xa00c04c
y.create.l HWIO_WCSS_A_FFT_FFT_RAM_10_0_ADDR A:0xa00c800
y.create.l HWIO_WCSS_A_FFT_FFT_RAM_11_0_ADDR A:0xa00c808
y.create.l HWIO_WCSS_A_FFT_FFT_RAM_12_0_ADDR A:0xa00c810
y.create.l HWIO_WCSS_A_FFT_FFT_RAM_13_0_ADDR A:0xa00c818
y.create.l HWIO_WCSS_A_FFT_FFT_RAM_14_0_ADDR A:0xa00c820
y.create.l HWIO_WCSS_A_FFT_FFT_RAM_15_0_ADDR A:0xa00c828
y.create.l HWIO_WCSS_A_FFT_FFT_RAM_16_0_ADDR A:0xa00c830
y.create.l HWIO_WCSS_A_FFT_FFT_RAM_17_0_ADDR A:0xa00c838
y.create.l HWIO_WCSS_A_FFT_FFT_RAM_18_0_ADDR A:0xa00c840
y.create.l HWIO_WCSS_A_FFT_FFT_RAM_19_0_ADDR A:0xa00c848
y.create.l HWIO_WCSS_A_FFT_FFT_RAM_10_1_ADDR A:0xa00c804
y.create.l HWIO_WCSS_A_FFT_FFT_RAM_11_1_ADDR A:0xa00c80c
y.create.l HWIO_WCSS_A_FFT_FFT_RAM_12_1_ADDR A:0xa00c814
y.create.l HWIO_WCSS_A_FFT_FFT_RAM_13_1_ADDR A:0xa00c81c
y.create.l HWIO_WCSS_A_FFT_FFT_RAM_14_1_ADDR A:0xa00c824
y.create.l HWIO_WCSS_A_FFT_FFT_RAM_15_1_ADDR A:0xa00c82c
y.create.l HWIO_WCSS_A_FFT_FFT_RAM_16_1_ADDR A:0xa00c834
y.create.l HWIO_WCSS_A_FFT_FFT_RAM_17_1_ADDR A:0xa00c83c
y.create.l HWIO_WCSS_A_FFT_FFT_RAM_18_1_ADDR A:0xa00c844
y.create.l HWIO_WCSS_A_FFT_FFT_RAM_19_1_ADDR A:0xa00c84c
y.create.l HWIO_WCSS_A_FFT_APB_ACCESS_ADDR A:0xa00d000
y.create.l HWIO_WCSS_A_FFT_FFT_TOGGLE_ADDR A:0xa00d004
y.create.l HWIO_WCSS_A_MCU_BD_PDU_BASE_ADDR_ADDR A:0xa080c00
y.create.l HWIO_WCSS_A_MCU_MLC_CONTROL_ADDR A:0xa080c04
y.create.l HWIO_WCSS_A_MCU_DBR_STATUS_ADDR A:0xa080c0c
y.create.l HWIO_WCSS_A_MCU_MCPU_TO_HOST_MB_INT_STAT_ADDR A:0xa080c10
y.create.l HWIO_WCSS_A_MCU_HOST_TO_MCPU_MB_INT_STAT_ADDR A:0xa080c14
y.create.l HWIO_WCSS_A_MCU_MB0_CONTROL_ADDR A:0xa080c18
y.create.l HWIO_WCSS_A_MCU_MB0_CONTROL_COUNTERS_ADDR A:0xa080c1c
y.create.l HWIO_WCSS_A_MCU_MB1_CONTROL_ADDR A:0xa080c20
y.create.l HWIO_WCSS_A_MCU_MB1_CONTROL_COUNTERS_ADDR A:0xa080c24
y.create.l HWIO_WCSS_A_MCU_MB2_CONTROL_ADDR A:0xa080c28
y.create.l HWIO_WCSS_A_MCU_MB2_CONTROL_COUNTERS_ADDR A:0xa080c2c
y.create.l HWIO_WCSS_A_MCU_MB3_CONTROL_ADDR A:0xa080c30
y.create.l HWIO_WCSS_A_MCU_MB3_CONTROL_COUNTERS_ADDR A:0xa080c34
y.create.l HWIO_WCSS_A_MCU_MUTEX0_ADDR A:0xa080c98
y.create.l HWIO_WCSS_A_MCU_MUTEX1_ADDR A:0xa080c9c
y.create.l HWIO_WCSS_A_MCU_MUTEX2_ADDR A:0xa080ca0
y.create.l HWIO_WCSS_A_MCU_MUTEX3_ADDR A:0xa080ca4
y.create.l HWIO_WCSS_A_MCU_SOFT_RESET_ADDR A:0xa080cb8
y.create.l HWIO_WCSS_A_MCU_MAC_CLK_GATING_ENABLE_ADDR A:0xa080cbc
y.create.l HWIO_WCSS_A_MCU_MAC_TESTBUS_CONTROL_ADDR A:0xa080cc0
y.create.l HWIO_WCSS_A_MCU_MAC_FPGA_VERSION_ADDR A:0xa080cc4
y.create.l HWIO_WCSS_A_MCU_MAC_MODULES_ROOT_CLK_ENABLES_ADDR A:0xa080cd4
y.create.l HWIO_WCSS_A_MCU_MAC_MODULES_GOTO_IDLE_CONTROL_ADDR A:0xa080cd8
y.create.l HWIO_WCSS_A_MCU_MAC_TESTBUS_LOW_ADDR A:0xa080cdc
y.create.l HWIO_WCSS_A_MCU_MAC_TESTBUS_HIGH_ADDR A:0xa080ce0
y.create.l HWIO_WCSS_A_MCU_APB2PHY_STATUS_ADDR A:0xa080cec
y.create.l HWIO_WCSS_A_MCU_MLC_STATUS_ADDR A:0xa080cf0
y.create.l HWIO_WCSS_A_MCU_RF_WARMUP_CONTROL_ADDR A:0xa080d00
y.create.l HWIO_WCSS_A_MCU_BTC_ADDR A:0xa080d04
y.create.l HWIO_WCSS_A_MCU_RF_ON_OFF_CONTROL_ADDR A:0xa080d08
y.create.l HWIO_WCSS_A_MCU_DEBUGC_CONTROL_ADDR A:0xa080d94
y.create.l HWIO_WCSS_A_MCU_DABH_MIF_PRIORITY_GENERATION_CONTROL_ADDR A:0xa080e10
y.create.l HWIO_WCSS_A_MCU_BTC_CTRL_ADDR A:0xa080e14
y.create.l HWIO_WCSS_A_MCU_BTC_CTRL2_ADDR A:0xa080e18
y.create.l HWIO_WCSS_A_MCU_BTC_CTRL3_ADDR A:0xa080e1c
y.create.l HWIO_WCSS_A_MCU_BTC_STATUS_ADDR A:0xa080e20
y.create.l HWIO_WCSS_A_MCU_BTC_STATUS2_ADDR A:0xa080e24
y.create.l HWIO_WCSS_A_MCU_BTC_FRAME1_STATUS_ADDR A:0xa080e2c
y.create.l HWIO_WCSS_A_MCU_BTC_FRAME2_STATUS_ADDR A:0xa080e30
y.create.l HWIO_WCSS_A_MCU_FIQ_EN_ADDR A:0xa080e38
y.create.l HWIO_WCSS_A_MCU_FIQ_STATUS_ADDR A:0xa080e3c
y.create.l HWIO_WCSS_A_MCU_FIQ_MASKED_STATUS_ADDR A:0xa080e40
y.create.l HWIO_WCSS_A_MCU_FIQ_CLEAR_ADDR A:0xa080e44
y.create.l HWIO_WCSS_A_MCU_IRQ_EN_ADDR A:0xa080e48
y.create.l HWIO_WCSS_A_MCU_IRQ_STATUS_ADDR A:0xa080e4c
y.create.l HWIO_WCSS_A_MCU_IRQ_MASKED_STATUS_ADDR A:0xa080e50
y.create.l HWIO_WCSS_A_MCU_IRQ_CLEAR_ADDR A:0xa080e54
y.create.l HWIO_WCSS_A_MCU_MTU_INT_EN_ADDR A:0xa080e58
y.create.l HWIO_WCSS_A_MCU_MTU_INT_STATUS_ADDR A:0xa080e5c
y.create.l HWIO_WCSS_A_MCU_MTU_INT_MASKED_STATUS_ADDR A:0xa080e60
y.create.l HWIO_WCSS_A_MCU_MTU_INT_CLEAR_ADDR A:0xa080e64
y.create.l HWIO_WCSS_A_MCU_COMBINED_INT_EN_ADDR A:0xa080e68
y.create.l HWIO_WCSS_A_MCU_COMBINED_INT_STATUS_ADDR A:0xa080e6c
y.create.l HWIO_WCSS_A_MCU_COMBINED_INT_MASKED_STATUS_ADDR A:0xa080e70
y.create.l HWIO_WCSS_A_MCU_COMBINED_INT_CLEAR_ADDR A:0xa080e74
y.create.l HWIO_WCSS_A_MCU_BMU_WQ_INT_EN_ADDR A:0xa080e78
y.create.l HWIO_WCSS_A_MCU_BMU_WQ_INT_STATUS_ADDR A:0xa080e7c
y.create.l HWIO_WCSS_A_MCU_BMU_WQ_INT_MASKED_STATUS_ADDR A:0xa080e80
y.create.l HWIO_WCSS_A_MCU_BMU_WQ_INT_CLEAR_ADDR A:0xa080e84
y.create.l HWIO_WCSS_A_MCU_SW_INT_0_ADDR A:0xa080e98
y.create.l HWIO_WCSS_A_MCU_SW_INT_1_ADDR A:0xa080e9c
y.create.l HWIO_WCSS_A_MCU_MCU_HOST_INT_EN_ADDR A:0xa080ea0
y.create.l HWIO_WCSS_A_MCU_MCU_HOST_INT_STATUS_ADDR A:0xa080ea4
y.create.l HWIO_WCSS_A_MCU_MCU_HOST_INT_MASKED_STATUS_ADDR A:0xa080ea8
y.create.l HWIO_WCSS_A_MCU_MCU_HOST_INT_CLEAR_ADDR A:0xa080eac
y.create.l HWIO_WCSS_A_MCU_MCU_PMU_INFO_ADDR A:0xa080eb0
y.create.l HWIO_WCSS_A_MCU_MCU_WMAC_STATUS_ADDR A:0xa080eb4
y.create.l HWIO_WCSS_A_MCU_MAC_HOST_INT_EN_ADDR A:0xa080eb8
y.create.l HWIO_WCSS_A_MCU_MAC_HOST_INT_STATUS_ADDR A:0xa080ebc
y.create.l HWIO_WCSS_A_MCU_MAC_HOST_INT_MASKED_STATUS_ADDR A:0xa080ec0
y.create.l HWIO_WCSS_A_MCU_MAC_HOST_INT_CLEAR_ADDR A:0xa080ec4
y.create.l HWIO_WCSS_A_MCU_MTU_HOST_INT_EN_ADDR A:0xa080ec8
y.create.l HWIO_WCSS_A_MCU_MTU_HOST_INT_MASKED_STATUS_ADDR A:0xa080ecc
y.create.l HWIO_WCSS_A_MCU_COMBINED_HOST_INT_EN_ADDR A:0xa080ed0
y.create.l HWIO_WCSS_A_MCU_COMBINED_HOST_INT_MASKED_STATUS_ADDR A:0xa080ed4
y.create.l HWIO_WCSS_A_MCU_BMU_WQ_HOST_INT_EN_ADDR A:0xa080ed8
y.create.l HWIO_WCSS_A_MCU_BMU_WQ_HOST_INT_MASKED_STATUS_ADDR A:0xa080edc
y.create.l HWIO_WCSS_A_MCU_MTU_TIMER_INTERRUPT_SOURCE_ADDR A:0xa080ee0
y.create.l HWIO_WCSS_A_MCU_BTC_CTRL4_ADDR A:0xa080f00
y.create.l HWIO_WCSS_A_MCU_BTC_PATTERN_DET1_ADDR A:0xa080f04
y.create.l HWIO_WCSS_A_MCU_BTC_PATTERN_DET2_ADDR A:0xa080f08
y.create.l HWIO_WCSS_A_MCU_BTC_PATTERN_HISTORY_ADDR A:0xa080f0c
y.create.l HWIO_WCSS_A_MCU_BTC_HI_GRANT_ADDR A:0xa080f10
y.create.l HWIO_WCSS_A_MCU_BTC_LOW_GRANT_ADDR A:0xa080f14
y.create.l HWIO_WCSS_A_MCU_BTC_REQ_CNT_ADDR A:0xa080f18
y.create.l HWIO_WCSS_A_MCU_MRCM_CLK_GATE_DISABLE_ADDR A:0xa080f1c
y.create.l HWIO_WCSS_A_MCU_TXP_BUSY_CNT_ADDR A:0xa080f20
y.create.l HWIO_WCSS_A_MCU_WLAN_BRIDGE_CTRL_ADDR A:0xa080f24
y.create.l HWIO_WCSS_A_MCU_BD_PDU_BASE_ADDR_LOCAL_ADDR A:0xa080f30
y.create.l HWIO_WCSS_A_MCU_CMEM_BDINDEX_THRESHOLD_ADDR A:0xa080f34
y.create.l HWIO_WCSS_A_MCU_CSU_CONFIGURATION_ADDR A:0xa080f38
y.create.l HWIO_WCSS_A_MCU_MCU_CSU_NEXTHDR_BITMAP_0_ADDR A:0xa080f3c
y.create.l HWIO_WCSS_A_MCU_MCU_CSU_NEXTHDR_BITMAP_1_ADDR A:0xa080f40
y.create.l HWIO_WCSS_A_MCU_MCU_CSU_NEXTHDR_BITMAP_2_ADDR A:0xa080f44
y.create.l HWIO_WCSS_A_MCU_MCU_CSU_NEXTHDR_BITMAP_3_ADDR A:0xa080f48
y.create.l HWIO_WCSS_A_MCU_MCU_CSU_NEXTHDR_BITMAP_4_ADDR A:0xa080f4c
y.create.l HWIO_WCSS_A_MCU_MCU_CSU_NEXTHDR_BITMAP_5_ADDR A:0xa080f50
y.create.l HWIO_WCSS_A_MCU_MCU_CSU_NEXTHDR_BITMAP_6_ADDR A:0xa080f54
y.create.l HWIO_WCSS_A_MCU_MCU_CSU_NEXTHDR_BITMAP_7_ADDR A:0xa080f58
y.create.l HWIO_WCSS_A_MCU_MCU_CSU_TX_WORK_QUEUES_ADDR A:0xa080f5c
y.create.l HWIO_WCSS_A_MCU_MCU_CSU_TX_DEBUG_COUNTERS1_ADDR A:0xa080f60
y.create.l HWIO_WCSS_A_MCU_MCU_CSU_TX_DEBUG_COUNTERS2_ADDR A:0xa080f64
y.create.l HWIO_WCSS_A_MCU_MCU_CSU_TX_DEBUG_COUNTERS3_ADDR A:0xa080f68
y.create.l HWIO_WCSS_A_MCU_MCU_CSU_RX_WORK_QUEUES_ADDR A:0xa080f6c
y.create.l HWIO_WCSS_A_MCU_MCU_CSU_RX_DEBUG_COUNTERS1_ADDR A:0xa080f70
y.create.l HWIO_WCSS_A_MCU_MCU_CSU_RX_DEBUG_COUNTERS2_ADDR A:0xa080f74
y.create.l HWIO_WCSS_A_MCU_MCU_CSU_RX_DEBUG_COUNTERS3_ADDR A:0xa080f78
y.create.l HWIO_WCSS_A_MCU_MCU_CSU_INTERRUPT_ADDR A:0xa080f7c
y.create.l HWIO_WCSS_A_MCU_MCU_CBR_CCAHB_ERR_ADDR_ADDR A:0xa080f80
y.create.l HWIO_WCSS_A_MCU_MCU_CBR_CAHB_ERR_ADDR_ADDR A:0xa080f84
y.create.l HWIO_WCSS_A_MCU_MCU_CBR_CCAHB_TIMEOUT_ADDR_ADDR A:0xa080f88
y.create.l HWIO_WCSS_A_MCU_MCU_CBR_CAHB_TIMEOUT_ADDR_ADDR A:0xa080f8c
y.create.l HWIO_WCSS_A_MCU_MCU_DBR_CDAHB_ERR_ADDR_ADDR A:0xa080f90
y.create.l HWIO_WCSS_A_MCU_MCU_DBR_DAHB_ERR_ADDR_ADDR A:0xa080f94
y.create.l HWIO_WCSS_A_MCU_MCU_DBR_CDAHB_TIMEOUT_ADDR_ADDR A:0xa080f98
y.create.l HWIO_WCSS_A_MCU_MCU_DBR_DAHB_TIMEOUT_ADDR_ADDR A:0xa080f9c
y.create.l HWIO_WCSS_A_MCU_MCU_FDBR_CDAHB_ERR_ADDR_ADDR A:0xa080fa0
y.create.l HWIO_WCSS_A_MCU_MCU_FDBR_FDAHB_ERR_ADDR_ADDR A:0xa080fa4
y.create.l HWIO_WCSS_A_MCU_MCU_FDBR_CDAHB_TIMEOUT_ADDR_ADDR A:0xa080fa8
y.create.l HWIO_WCSS_A_MCU_MCU_FDBR_FDAHB_TIMEOUT_ADDR_ADDR A:0xa080fac
y.create.l HWIO_WCSS_A_MCU_MCU_WLAN_BRIDGE_ERR_TIMEOUT_SRC_ADDR A:0xa080fb0
y.create.l HWIO_WCSS_A_MPI_WATCHDOG_MAX_COMMAND1_ADDR A:0xa013400
y.create.l HWIO_WCSS_A_MPI_WATCHDOG_MAX_COMMAND2_ADDR A:0xa013404
y.create.l HWIO_WCSS_A_MPI_WATCHDOG_MAX_WAIT_ADDR A:0xa013408
y.create.l HWIO_WCSS_A_MPI_WATCHDOG_MAX_TRANSFER_ADDR A:0xa01340c
y.create.l HWIO_WCSS_A_MPI_MAX_REQAORB_ADDR A:0xa013410
y.create.l HWIO_WCSS_A_MPI_COMMAND2_DELAY_ADDR A:0xa013414
y.create.l HWIO_WCSS_A_MPI_MPI_ENABLE_ADDR A:0xa013418
y.create.l HWIO_WCSS_A_MPI_TXP_MPI_START_ADDR A:0xa01341c
y.create.l HWIO_WCSS_A_MPI_MPI_TXP_REQ_ADDR A:0xa013420
y.create.l HWIO_WCSS_A_MPI_TXA_MPI_DATA_REQ_ADDR A:0xa013424
y.create.l HWIO_WCSS_A_MPI_TXB_MPI_DATA_REQ_ADDR A:0xa013428
y.create.l HWIO_WCSS_A_MPI_TXP_MPI_DATA_VAL_ADDR A:0xa01342c
y.create.l HWIO_WCSS_A_MPI_MPI_TXA_DATA_VAL_ADDR A:0xa013430
y.create.l HWIO_WCSS_A_MPI_MPI_TXB_DATA_VAL_ADDR A:0xa013434
y.create.l HWIO_WCSS_A_MPI_MPI_TXA_LASTBYTE_ADDR A:0xa013438
y.create.l HWIO_WCSS_A_MPI_MPI_TXA_CW_LASTBYTE_ADDR A:0xa01343c
y.create.l HWIO_WCSS_A_MPI_MPI_TXA_CW_MAX_PARITY_ADDR A:0xa013440
y.create.l HWIO_WCSS_A_MPI_MPI_STATE_ADDR A:0xa013444
y.create.l HWIO_WCSS_A_MPI_STATUS_FLAGS_ADDR A:0xa013448
y.create.l HWIO_WCSS_A_MPI_REQ_ALARM_ADDR A:0xa01344c
y.create.l HWIO_WCSS_A_MPI_WATCHDOG_ALARM_ADDR A:0xa013450
y.create.l HWIO_WCSS_A_MPI_COMMAND_ALARM_ADDR A:0xa013454
y.create.l HWIO_WCSS_A_MPI_TXP_ABORT_ADDR A:0xa013458
y.create.l HWIO_WCSS_A_MPI_TXCTL_ABORT_ADDR A:0xa01345c
y.create.l HWIO_WCSS_A_MTU_DIFS_LIMIT_0TO3_ADDR A:0xa081400
y.create.l HWIO_WCSS_A_MTU_DIFS_LIMIT_4TO7_ADDR A:0xa081404
y.create.l HWIO_WCSS_A_MTU_EIFS_PIFS_SLOT_LIMIT_ADDR A:0xa081408
y.create.l HWIO_WCSS_A_MTU_SW_MTU_BCN_SLOT_USEC_SIFS_LIMIT_ADDR A:0xa08140c
y.create.l HWIO_WCSS_A_MTU_SW_MTU_MISC_LIMITS_ADDR A:0xa081410
y.create.l HWIO_WCSS_A_MTU_NAV_CNT_ADDR A:0xa081414
y.create.l HWIO_WCSS_A_MTU_TSF_TIMER_LO_ADDR A:0xa081418
y.create.l HWIO_WCSS_A_MTU_TSF_TIMER_HI_ADDR A:0xa08141c
y.create.l HWIO_WCSS_A_MTU_TIMER_0_ADDR A:0xa081420
y.create.l HWIO_WCSS_A_MTU_TIMER_1_ADDR A:0xa081424
y.create.l HWIO_WCSS_A_MTU_TIMER_2_ADDR A:0xa081428
y.create.l HWIO_WCSS_A_MTU_TIMER_3_ADDR A:0xa08142c
y.create.l HWIO_WCSS_A_MTU_TIMER_4_ADDR A:0xa081430
y.create.l HWIO_WCSS_A_MTU_TIMER_5_ADDR A:0xa081434
y.create.l HWIO_WCSS_A_MTU_TIMER_6_ADDR A:0xa081438
y.create.l HWIO_WCSS_A_MTU_TIMER_7_ADDR A:0xa08143c
y.create.l HWIO_WCSS_A_MTU_TIMER_CONTROL_ADDR A:0xa081440
y.create.l HWIO_WCSS_A_MTU_BKOF_CNT_0_ADDR A:0xa081444
y.create.l HWIO_WCSS_A_MTU_BKOF_CNT_1_ADDR A:0xa081448
y.create.l HWIO_WCSS_A_MTU_BKOF_CNT_2_ADDR A:0xa08144c
y.create.l HWIO_WCSS_A_MTU_BKOF_CNT_3_ADDR A:0xa081450
y.create.l HWIO_WCSS_A_MTU_BKOF_CNT_4_ADDR A:0xa081454
y.create.l HWIO_WCSS_A_MTU_BKOF_CNT_5_ADDR A:0xa081458
y.create.l HWIO_WCSS_A_MTU_BKOF_CNT_6_ADDR A:0xa08145c
y.create.l HWIO_WCSS_A_MTU_BKOF_CNT_7_ADDR A:0xa081460
y.create.l HWIO_WCSS_A_MTU_BKOF_CONTROL_ADDR A:0xa081464
y.create.l HWIO_WCSS_A_MTU_CW_REG_CONTROL_FOR_BACKOFF_0_ADDR A:0xa081468
y.create.l HWIO_WCSS_A_MTU_CW_REG_CONTROL_FOR_BACKOFF_1_ADDR A:0xa08146c
y.create.l HWIO_WCSS_A_MTU_CW_REG_CONTROL_FOR_BACKOFF_2_ADDR A:0xa081470
y.create.l HWIO_WCSS_A_MTU_CW_REG_CONTROL_FOR_BACKOFF_3_ADDR A:0xa081474
y.create.l HWIO_WCSS_A_MTU_CW_REG_CONTROL_FOR_BACKOFF_4_ADDR A:0xa081478
y.create.l HWIO_WCSS_A_MTU_CW_REG_CONTROL_FOR_BACKOFF_5_ADDR A:0xa08147c
y.create.l HWIO_WCSS_A_MTU_CW_REG_CONTROL_FOR_BACKOFF_6_ADDR A:0xa081480
y.create.l HWIO_WCSS_A_MTU_CW_REG_CONTROL_FOR_BACKOFF_7_ADDR A:0xa081484
y.create.l HWIO_WCSS_A_MTU_MTU_INTERRUPT_STATUS_ADDR A:0xa081488
y.create.l HWIO_WCSS_A_MTU_SW_MATCH_REGISTER_0_ADDR A:0xa08148c
y.create.l HWIO_WCSS_A_MTU_SW_MATCH_REGISTER_1_ADDR A:0xa081490
y.create.l HWIO_WCSS_A_MTU_SW_MATCH_REGISTER_2_ADDR A:0xa081494
y.create.l HWIO_WCSS_A_MTU_SW_MATCH_REGISTER_3_ADDR A:0xa081498
y.create.l HWIO_WCSS_A_MTU_SW_MATCH_REGISTER_4_ADDR A:0xa08149c
y.create.l HWIO_WCSS_A_MTU_SW_MATCH_REGISTER_5_ADDR A:0xa0814a0
y.create.l HWIO_WCSS_A_MTU_SW_MATCH_REGISTER_6_ADDR A:0xa0814a4
y.create.l HWIO_WCSS_A_MTU_SW_MATCH_REGISTER_7_ADDR A:0xa0814a8
y.create.l HWIO_WCSS_A_MTU_SW_CW_MIN_CW_MAX_0_ADDR A:0xa0814ac
y.create.l HWIO_WCSS_A_MTU_SW_CW_MIN_CW_MAX_1_ADDR A:0xa0814b0
y.create.l HWIO_WCSS_A_MTU_SW_CW_MIN_CW_MAX_2_ADDR A:0xa0814b4
y.create.l HWIO_WCSS_A_MTU_SW_CW_MIN_CW_MAX_3_ADDR A:0xa0814b8
y.create.l HWIO_WCSS_A_MTU_SW_CW_MIN_CW_MAX_4_ADDR A:0xa0814bc
y.create.l HWIO_WCSS_A_MTU_SW_CW_MIN_CW_MAX_5_ADDR A:0xa0814c0
y.create.l HWIO_WCSS_A_MTU_SW_CW_MIN_CW_MAX_6_ADDR A:0xa0814c4
y.create.l HWIO_WCSS_A_MTU_SW_CW_MIN_CW_MAX_7_ADDR A:0xa0814c8
y.create.l HWIO_WCSS_A_MTU_CCA_COUNTER0_ADDR A:0xa0814cc
y.create.l HWIO_WCSS_A_MTU_CCA_COUNTER1_ADDR A:0xa0814d0
y.create.l HWIO_WCSS_A_MTU_CCA_COUNTER2_ADDR A:0xa0814d4
y.create.l HWIO_WCSS_A_MTU_WATCH_DOG_TIMER_ADDR A:0xa0814d8
y.create.l HWIO_WCSS_A_MTU_WATCH_DOG_THR0_ADDR A:0xa0814dc
y.create.l HWIO_WCSS_A_MTU_WATCH_DOG_THR1_ADDR A:0xa0814e0
y.create.l HWIO_WCSS_A_MTU_WATCH_DOG_THR2_ADDR A:0xa0814e4
y.create.l HWIO_WCSS_A_MTU_BKOF_SW_INT_TYPE_ADDR A:0xa0814e8
y.create.l HWIO_WCSS_A_MTU_CCA_CONTROL_REG_ADDR A:0xa0814ec
y.create.l HWIO_WCSS_A_MTU_TIMER_8_ADDR A:0xa0814f0
y.create.l HWIO_WCSS_A_MTU_TIMER_9_ADDR A:0xa0814f4
y.create.l HWIO_WCSS_A_MTU_TIMER_10_ADDR A:0xa0814f8
y.create.l HWIO_WCSS_A_MTU_TIMER_11_ADDR A:0xa0814fc
y.create.l HWIO_WCSS_A_MTU_SW_MATCH_REGISTER_8_ADDR A:0xa081510
y.create.l HWIO_WCSS_A_MTU_SW_MATCH_REGISTER_9_ADDR A:0xa081514
y.create.l HWIO_WCSS_A_MTU_SW_MATCH_REGISTER_10_ADDR A:0xa081518
y.create.l HWIO_WCSS_A_MTU_SW_MATCH_REGISTER_11_ADDR A:0xa08151c
y.create.l HWIO_WCSS_A_MTU_BKOF_CONTROL2_ADDR A:0xa081534
y.create.l HWIO_WCSS_A_MTU_CCA_CONTROL_REG2_ADDR A:0xa081538
y.create.l HWIO_WCSS_A_MTU_TIMER_CONTROL11TO8_ADDR A:0xa08154c
y.create.l HWIO_WCSS_A_MTU_MTU_GLOBAL_CONTROL_ADDR A:0xa081550
y.create.l HWIO_WCSS_A_MTU_MTU_INTERRUPT_STATUS11TO8_ADDR A:0xa081554
y.create.l HWIO_WCSS_A_MTU_MTU_GLOBAL_CONTROL2_ADDR A:0xa081558
y.create.l HWIO_WCSS_A_MTU_SW_MTU_SHADOW_NAV_CNT_ADDR A:0xa08155c
y.create.l HWIO_WCSS_A_MTU_PRIMARY_CCA_HISTOGRAM_LO_ADDR A:0xa081560
y.create.l HWIO_WCSS_A_MTU_PRIMARY_CCA_HISTOGRAM_HI_ADDR A:0xa081564
y.create.l HWIO_WCSS_A_MTU_SECONDARY_CCA_HISTOGRAM_LO_ADDR A:0xa081568
y.create.l HWIO_WCSS_A_MTU_SECONDARY_CCA_HISTOGRAM_HI_ADDR A:0xa08156c
y.create.l HWIO_WCSS_A_MTU_TIMEOUT_LIMIT_ADDR A:0xa081570
y.create.l HWIO_WCSS_A_MTU_CCA_FINAL_CONTROL_REG_ADDR A:0xa081574
y.create.l HWIO_WCSS_A_MTU_EARLY_INTERRUPT_LIMITS_ADDR A:0xa08157c
y.create.l HWIO_WCSS_A_MTU_BTC_CONFIG_REGISTERS_ADDR A:0xa081580
y.create.l HWIO_WCSS_A_MTU_MTU_TESTBUS_LOW_ADDR A:0xa081584
y.create.l HWIO_WCSS_A_MTU_MTU_TESTBUS_HIGH_ADDR A:0xa081588
y.create.l HWIO_WCSS_A_MTU_MTU_FOR_HMAC_CONTROLS_ADDR A:0xa08158c
y.create.l HWIO_WCSS_A_MTU_MTU_DTIM_CNT_AND_PERIOD_ADDR A:0xa081590
y.create.l HWIO_WCSS_A_MTU_DTIM_THRSH_CNT_AND_LIMIT_ADDR A:0xa081594
y.create.l HWIO_WCSS_A_MTU_TBTT_L_ADDR A:0xa081598
y.create.l HWIO_WCSS_A_MTU_TBTT_H_ADDR A:0xa08159c
y.create.l HWIO_WCSS_A_MTU_M_TBTT_L_ADDR A:0xa0815a0
y.create.l HWIO_WCSS_A_MTU_M_TBTT_H_ADDR A:0xa0815a4
y.create.l HWIO_WCSS_A_MTU_BCN_BSSID_INTV_ADDR A:0xa0815a8
y.create.l HWIO_WCSS_A_MTU_VALID_BSSID_BITMAP_ADDR A:0xa0815ac
y.create.l HWIO_WCSS_A_MTU_IBSS_BKOF_CNT_ADDR A:0xa0815b0
y.create.l HWIO_WCSS_A_MTU_LFSR_DATA_1_0_ADDR A:0xa0815b4
y.create.l HWIO_WCSS_A_MTU_LFSR_DATA_3_2_ADDR A:0xa0815b8
y.create.l HWIO_WCSS_A_MTU_LFSR_DATA_5_4_ADDR A:0xa0815bc
y.create.l HWIO_WCSS_A_MTU_LFSR_DATA_7_6_ADDR A:0xa0815c0
y.create.l HWIO_WCSS_A_MTU_LONG_SHORT_XMIT_LIMIT_BKOF_3_TO_0_ADDR A:0xa0815c4
y.create.l HWIO_WCSS_A_MTU_LONG_SHORT_XMIT_LIMIT_BKOF_7_TO_4_ADDR A:0xa0815c8
y.create.l HWIO_WCSS_A_MTU_WARMUP_LIMIT_ADDR A:0xa0815cc
y.create.l HWIO_WCSS_A_MTU_ONE_SEC_LIMIT_ADDR A:0xa0815d0
y.create.l HWIO_WCSS_A_MTU_MTU_GLOBAL_TIMER_ADDR A:0xa0815d4
y.create.l HWIO_WCSS_A_MTU_TSF_TIMER_FOR_SIM_BSS_LO_ADDR A:0xa0815d8
y.create.l HWIO_WCSS_A_MTU_TSF_TIMER_FOR_SIM_BSS_HI_ADDR A:0xa0815dc
y.create.l HWIO_WCSS_A_MTU_SW_MTU_SIFS_LIMIT_FORINNAV_ADDR A:0xa0815e0
y.create.l HWIO_WCSS_A_MTU_SW_MTU_P2P_GO_TSF_TIMER_LO_ADDR A:0xa0815e4
y.create.l HWIO_WCSS_A_MTU_SW_MTU_P2P_GO_TSF_TIMER_HI_ADDR A:0xa0815e8
y.create.l HWIO_WCSS_A_MTU_SW_MTU_P2P_CLIENT_TSF_TIMER_LO_ADDR A:0xa0815ec
y.create.l HWIO_WCSS_A_MTU_SW_MTU_P2P_CLIENT_TSF_TIMER_HI_ADDR A:0xa0815f0
y.create.l HWIO_WCSS_A_MTU_SW_MTU_P2P_CTRL_ADDR A:0xa0815f4
y.create.l HWIO_WCSS_A_MTU_SW_MTU_P2P_TRANSMIT_BOUNDARY_ADDR A:0xa0815f8
y.create.l HWIO_WCSS_A_MTU_SW_MTU_P2P_WAIT_FOR_BEACON_ADDR A:0xa0815fc
y.create.l HWIO_WCSS_A_MTU_TERTIARY_CCA_HISTOGRAM_LO_ADDR A:0xa081600
y.create.l HWIO_WCSS_A_MTU_TERTIARY_CCA_HISTOGRAM_HI_ADDR A:0xa081604
y.create.l HWIO_WCSS_A_MTU_QUATERNARY_CCA_HISTOGRAM_LO_ADDR A:0xa081608
y.create.l HWIO_WCSS_A_MTU_QUATERNARY_CCA_HISTOGRAM_HI_ADDR A:0xa08160c
y.create.l HWIO_WCSS_A_MTU_MTU_CCA_CONTROL_ADDR A:0xa081610
y.create.l HWIO_WCSS_A_MTU_MTU_CCA_STATUS_ADDR A:0xa081614
y.create.l HWIO_WCSS_A_MTU_ADD_TSF_TIMER_LO_ADDR A:0xa081618
y.create.l HWIO_WCSS_A_MTU_ADD_TSF_TIMER_HI_ADDR A:0xa08161c
y.create.l HWIO_WCSS_A_MTU_TSF_TIMER_CTRL_ADDR A:0xa081620
y.create.l HWIO_WCSS_A_MTU_MTU_LTE_CXM_TSF_LOW_ADDR A:0xa081624
y.create.l HWIO_WCSS_A_MTU_MTU_LTE_CXM_TSF_HIGH_ADDR A:0xa081628
y.create.l HWIO_WCSS_A_MTU_SW_SECONDARY_CCA_HISTOGRAM_MASK_ADDR A:0xa08162c
y.create.l HWIO_WCSS_A_MTU_SW_TERTIARY_CCA_HISTOGRAM_MASK_ADDR A:0xa081630
y.create.l HWIO_WCSS_A_MTU_SW_QUATERNARY_CCA_HISTOGRAM_MASK_ADDR A:0xa081634
y.create.l HWIO_WCSS_A_MTU_SW_CCA_HISTOGRAM_MASK_MISC_ADDR A:0xa081638
y.create.l HWIO_WCSS_A_MTU_CCA_SECONDARY_HISTOGRAM_ADDR A:0xa08163c
y.create.l HWIO_WCSS_A_MTU_CCA_TERTIARY_HISTOGRAM_ADDR A:0xa081640
y.create.l HWIO_WCSS_A_MTU_CCA_QUATERNARY_HISTOGRAM_ADDR A:0xa081644
y.create.l HWIO_WCSS_A_MTU_MTU_MISC_FOR_TVWS_1_ADDR A:0xa081648
y.create.l HWIO_WCSS_A_MTU_CCA_COUNTER3_ADDR A:0xa08164c
y.create.l HWIO_WCSS_A_MTU_CCA_COUNTER4_ADDR A:0xa081650
y.create.l HWIO_WCSS_A_MTU_CCA_COUNTER5_ADDR A:0xa081654
y.create.l HWIO_WCSS_A_MTU_BSS2_CLIENT_TSF_TIMER_LO_ADDR A:0xa081658
y.create.l HWIO_WCSS_A_MTU_BSS2_CLIENT_TSF_TIMER_HI_ADDR A:0xa08165c
y.create.l HWIO_WCSS_A_MTU_QBOOST_CONTROL_ADDR A:0xa081660
y.create.l HWIO_WCSS_A_MTU_SW_MTU_P2P_TRANSMIT_BOUNDARY2_ADDR A:0xa081664
y.create.l HWIO_WCSS_A_MTU_SW_MTU_P2P_TRANSMIT_BOUNDARY3_ADDR A:0xa081668
y.create.l HWIO_WCSS_A_MTU_SW_MTU_P2P_TRANSMIT_BOUNDARY4_ADDR A:0xa08166c
y.create.l HWIO_WCSS_A_PHYDBG_CFGMODE_ADDR A:0xa004000
y.create.l HWIO_WCSS_A_PHYDBG_SELTRIG_ADDR A:0xa004004
y.create.l HWIO_WCSS_A_PHYDBG_RST0_ADDR A:0xa004008
y.create.l HWIO_WCSS_A_PHYDBG_RST1_ADDR A:0xa00400c
y.create.l HWIO_WCSS_A_PHYDBG_START0_ADDR A:0xa004010
y.create.l HWIO_WCSS_A_PHYDBG_START1_ADDR A:0xa004014
y.create.l HWIO_WCSS_A_PHYDBG_STATUS_ADDR A:0xa004018
y.create.l HWIO_WCSS_A_PHYDBG_DELAY0_ADDR A:0xa00401c
y.create.l HWIO_WCSS_A_PHYDBG_TRIGPTR0_ADDR A:0xa004020
y.create.l HWIO_WCSS_A_PHYDBG_TMUX_STRBQUAL_ADDR A:0xa004024
y.create.l HWIO_WCSS_A_PHYDBG_CAPT_CFG_ADDR A:0xa004028
y.create.l HWIO_WCSS_A_PHYDBG_CAPT_CFG2_ADDR A:0xa00402c
y.create.l HWIO_WCSS_A_PHYDBG_START_TRIGWD0_ADDR A:0xa004030
y.create.l HWIO_WCSS_A_PHYDBG_END_TRIGWD0_ADDR A:0xa004034
y.create.l HWIO_WCSS_A_PHYDBG_STOP_TRIGWD0_ADDR A:0xa004038
y.create.l HWIO_WCSS_A_PHYDBG_START_ADDR0_ADDR A:0xa00403c
y.create.l HWIO_WCSS_A_PHYDBG_MAX_ADDR0_ADDR A:0xa004040
y.create.l HWIO_WCSS_A_PHYDBG_START_ADDR1_ADDR A:0xa004044
y.create.l HWIO_WCSS_A_PHYDBG_MAX_ADDR1_ADDR A:0xa004048
y.create.l HWIO_WCSS_A_PHYDBG_AGCRST_ADDR A:0xa00404c
y.create.l HWIO_WCSS_A_PHYDBG_TMUX_STRIG_ADDR A:0xa004050
y.create.l HWIO_WCSS_A_PHYDBG_TMUX_ETRIG_ADDR A:0xa004054
y.create.l HWIO_WCSS_A_PHYDBG_PLYBCK_CFG_ADDR A:0xa004058
y.create.l HWIO_WCSS_A_PHYDBG_PLYBCK_CFG2_ADDR A:0xa00405c
y.create.l HWIO_WCSS_A_PHYDBG_PRBS_ADDR A:0xa004060
y.create.l HWIO_WCSS_A_PHYDBG_PRBS_MS_ADDR A:0xa004064
y.create.l HWIO_WCSS_A_PHYDBG_PRBS_LOAD_ADDR A:0xa004068
y.create.l HWIO_WCSS_A_PHYDBG_TXPKT_CNT_ADDR A:0xa00406c
y.create.l HWIO_WCSS_A_PHYDBG_RXPKT_CNT_ADDR A:0xa004070
y.create.l HWIO_WCSS_A_PHYDBG_CAPTCNT_ADDR A:0xa004074
y.create.l HWIO_WCSS_A_PHYDBG_POSTTRIGCNT_ADDR A:0xa004078
y.create.l HWIO_WCSS_A_PHYDBG_WARMUP_DLY_ADDR A:0xa00407c
y.create.l HWIO_WCSS_A_PHYDBG_RXPKT_FILTER_10_ADDR A:0xa004080
y.create.l HWIO_WCSS_A_PHYDBG_RXPKT_FILTER_32_ADDR A:0xa004084
y.create.l HWIO_WCSS_A_PHYDBG_PLYBKCNT_ADDR A:0xa004088
y.create.l HWIO_WCSS_A_PHYDBG_AMPDU_RXPKT_CNT_ADDR A:0xa00408c
y.create.l HWIO_WCSS_A_PHYDBG_AUTO_TRIG_PLAYBACK1_ADDR A:0xa004090
y.create.l HWIO_WCSS_A_PHYDBG_AUTO_TRIG_PLAYBACK_DELAY1_ADDR A:0xa004094
y.create.l HWIO_WCSS_A_PHYDBG_AUTO_TRIG_PLAYBACK_TIMEOUT_DELAY1_ADDR A:0xa004098
y.create.l HWIO_WCSS_A_PHYDBG_GPIO_OUT_TRIG_ADDR A:0xa00409c
y.create.l HWIO_WCSS_A_PHYDBG_AUTO_CAPT_CNT_ADDR A:0xa0040a0
y.create.l HWIO_WCSS_A_PHYDBG_DBGMEM0_0_ADDR A:0xa006000
y.create.l HWIO_WCSS_A_PHYDBG_DBGMEM1_0_ADDR A:0xa006008
y.create.l HWIO_WCSS_A_PHYDBG_DBGMEM2_0_ADDR A:0xa006010
y.create.l HWIO_WCSS_A_PHYDBG_DBGMEM3_0_ADDR A:0xa006018
y.create.l HWIO_WCSS_A_PHYDBG_DBGMEM4_0_ADDR A:0xa006020
y.create.l HWIO_WCSS_A_PHYDBG_DBGMEM5_0_ADDR A:0xa006028
y.create.l HWIO_WCSS_A_PHYDBG_DBGMEM6_0_ADDR A:0xa006030
y.create.l HWIO_WCSS_A_PHYDBG_DBGMEM7_0_ADDR A:0xa006038
y.create.l HWIO_WCSS_A_PHYDBG_DBGMEM8_0_ADDR A:0xa006040
y.create.l HWIO_WCSS_A_PHYDBG_DBGMEM9_0_ADDR A:0xa006048
y.create.l HWIO_WCSS_A_PHYDBG_DBGMEM0_1_ADDR A:0xa006004
y.create.l HWIO_WCSS_A_PHYDBG_DBGMEM1_1_ADDR A:0xa00600c
y.create.l HWIO_WCSS_A_PHYDBG_DBGMEM2_1_ADDR A:0xa006014
y.create.l HWIO_WCSS_A_PHYDBG_DBGMEM3_1_ADDR A:0xa00601c
y.create.l HWIO_WCSS_A_PHYDBG_DBGMEM4_1_ADDR A:0xa006024
y.create.l HWIO_WCSS_A_PHYDBG_DBGMEM5_1_ADDR A:0xa00602c
y.create.l HWIO_WCSS_A_PHYDBG_DBGMEM6_1_ADDR A:0xa006034
y.create.l HWIO_WCSS_A_PHYDBG_DBGMEM7_1_ADDR A:0xa00603c
y.create.l HWIO_WCSS_A_PHYDBG_DBGMEM8_1_ADDR A:0xa006044
y.create.l HWIO_WCSS_A_PHYDBG_DBGMEM9_1_ADDR A:0xa00604c
y.create.l HWIO_WCSS_A_PHYINT_STATUS_ADDR A:0xa015c00
y.create.l HWIO_WCSS_A_PHYINT_FAST_MASK_ADDR A:0xa015c04
y.create.l HWIO_WCSS_A_PHYINT_SLOW_MASK_ADDR A:0xa015c08
y.create.l HWIO_WCSS_A_PHYINT_HOST_MASK_ADDR A:0xa015c0c
y.create.l HWIO_WCSS_A_PMI_PMI_STATE_ADDR A:0xa013800
y.create.l HWIO_WCSS_A_PMI_RXA_PKTS_ADDR A:0xa013804
y.create.l HWIO_WCSS_A_PMI_RXB_PACKETS_ADDR A:0xa01380c
y.create.l HWIO_WCSS_A_PMI_RXA_DATA_VALID_ADDR A:0xa013810
y.create.l HWIO_WCSS_A_PMI_RXB_DATA_VALID_ADDR A:0xa013814
y.create.l HWIO_WCSS_A_PMI_RXP_SHUTOFF_ADDR A:0xa013818
y.create.l HWIO_WCSS_A_PMI_RXP_MU_EOP_ADDR A:0xa01381c
y.create.l HWIO_WCSS_A_PMI_PHY_STARTS_ADDR A:0xa013820
y.create.l HWIO_WCSS_A_PMI_PHY_DATA_VAL_ADDR A:0xa013824
y.create.l HWIO_WCSS_A_PMI_PHY_ABORT_ADDR A:0xa013828
y.create.l HWIO_WCSS_A_PMI_PHY_INT_ADDR A:0xa01382c
y.create.l HWIO_WCSS_A_PMI_WATCHDOG_TIMEOUT_GENERAL_ADDR A:0xa013830
y.create.l HWIO_WCSS_A_PMI_WATCHDOG_TIMEOUT_11A_ADDR A:0xa013834
y.create.l HWIO_WCSS_A_PMI_WATCHDOG_TIMEOUT_11B_ADDR A:0xa013838
y.create.l HWIO_WCSS_A_PMI_DISABLE_FLAGS_ADDR A:0xa01383c
y.create.l HWIO_WCSS_A_PMI_CRC_FSM_RESET_ADDR A:0xa013840
y.create.l HWIO_WCSS_A_PMI_RXPKT_FILTER_LSW_ADDR A:0xa013844
y.create.l HWIO_WCSS_A_PMI_RXPKT_FILTER_MSW_ADDR A:0xa013848
y.create.l HWIO_WCSS_A_PMI_CRC_DONE_ADDR A:0xa01384c
y.create.l HWIO_WCSS_A_PMI_CRC_PASS_ADDR A:0xa013850
y.create.l HWIO_WCSS_A_PMI_AMPDU_BAD_ADDR A:0xa013854
y.create.l HWIO_WCSS_A_PMI_AMPDU_GOOD_ADDR A:0xa013858
y.create.l HWIO_WCSS_A_PMI_AMPDU_DONE_ADDR A:0xa01385c
y.create.l HWIO_WCSS_A_PMI_LAST_STATS0_ADDR A:0xa013860
y.create.l HWIO_WCSS_A_PMI_LAST_STATS1_ADDR A:0xa013864
y.create.l HWIO_WCSS_A_PMI_LAST_STATS2_ADDR A:0xa013868
y.create.l HWIO_WCSS_A_PMI_LAST_STATS3_ADDR A:0xa01386c
y.create.l HWIO_WCSS_A_QTA_INTR_ADDR A:0xa080fc0
y.create.l HWIO_WCSS_A_QTA_INTR_EN_ADDR A:0xa080fc4
y.create.l HWIO_WCSS_A_QTA_UART_CTRL_ADDR A:0xa080fc8
y.create.l HWIO_WCSS_A_QTA_HW_CTRL_ADDR A:0xa080fcc
y.create.l HWIO_WCSS_A_QTA_HW_TX_BUFFER_MODIFY_ADDR A:0xa080fd0
y.create.l HWIO_WCSS_A_QTA_SW_CTRL_ADDR A:0xa080fd4
y.create.l HWIO_WCSS_A_QTA_SW_TX_FIFO_IN_ADDR A:0xa080fd8
y.create.l HWIO_WCSS_A_QTA_SW_RX_FIFO_OUT_ADDR A:0xa080fdc
y.create.l HWIO_WCSS_A_QTA_TESTBUS_ADDR A:0xa080fe0
y.create.l HWIO_WCSS_A_RACTL_PTC_LOOP_EN_ADDR A:0xa00f000
y.create.l HWIO_WCSS_A_RACTL_PTC_LOOP_GAIN_ADDR A:0xa00f004
y.create.l HWIO_WCSS_A_RACTL_PTC_CHAN_FREQ_ADDR A:0xa00f008
y.create.l HWIO_WCSS_A_RACTL_RACTL_CFG_ADDR A:0xa00f00c
y.create.l HWIO_WCSS_A_RACTL_RXA_ABORT_ADDR A:0xa00f010
y.create.l HWIO_WCSS_A_RACTL_RACTL_TOFFSET_ADDR A:0xa00f014
y.create.l HWIO_WCSS_A_RACTL_RACTL_DELTAT_IN_ADDR A:0xa00f018
y.create.l HWIO_WCSS_A_RACTL_RACTL_DELTAT_OUT_ADDR A:0xa00f01c
y.create.l HWIO_WCSS_A_RACTL_RACTL_DELTAF_IN_ADDR A:0xa00f020
y.create.l HWIO_WCSS_A_RACTL_RACTL_DELTAF_OUT_ADDR A:0xa00f024
y.create.l HWIO_WCSS_A_RACTL_PTC_DELTAAMP_TIMINGOFFSET_OUT_ADDR A:0xa00f028
y.create.l HWIO_WCSS_A_RACTL_RACTL_TEST_SIG_LEN_ADDR A:0xa00f02c
y.create.l HWIO_WCSS_A_RACTL_RACTL_TEST_CFG_ADDR A:0xa00f030
y.create.l HWIO_WCSS_A_RACTL_TESTMUX_SEL_ADDR A:0xa00f034
y.create.l HWIO_WCSS_A_RACTL_RACTL_PKTCOUNT_ADDR A:0xa00f038
y.create.l HWIO_WCSS_A_RACTL_RACTL_SYMCOUNT_ADDR A:0xa00f03c
y.create.l HWIO_WCSS_A_RACTL_RACTL_PKTCOUNT_AC20_ADDR A:0xa00f040
y.create.l HWIO_WCSS_A_RACTL_RACTL_PKTCOUNT_AC40_ADDR A:0xa00f044
y.create.l HWIO_WCSS_A_RACTL_RACTL_PKTCOUNT_AC80_ADDR A:0xa00f048
y.create.l HWIO_WCSS_A_RACTL_RACTL_PKTCOUNT_AC_SU_ADDR A:0xa00f04c
y.create.l HWIO_WCSS_A_RACTL_RACTL_PKTCOUNT_AC_MU_ADDR A:0xa00f050
y.create.l HWIO_WCSS_A_RACTL_CHE_PKTCOUNT_ADDR A:0xa00f054
y.create.l HWIO_WCSS_A_RACTL_PTC_PKTCOUNT_ADDR A:0xa00f058
y.create.l HWIO_WCSS_A_RACTL_PTC_SYMCOUNT_ADDR A:0xa00f05c
y.create.l HWIO_WCSS_A_RACTL_PTC_PKTCOUNT_20M_ADDR A:0xa00f060
y.create.l HWIO_WCSS_A_RACTL_PTC_PKTCOUNT_40M_ADDR A:0xa00f064
y.create.l HWIO_WCSS_A_RACTL_PTC_PKTCOUNT_SIMO_ADDR A:0xa00f068
y.create.l HWIO_WCSS_A_RACTL_PTC_PKTCOUNT_STBC_ADDR A:0xa00f06c
y.create.l HWIO_WCSS_A_RACTL_PTC_PKTCOUNT_GF_ADDR A:0xa00f070
y.create.l HWIO_WCSS_A_RACTL_PTC_PKTCOUNT_MM_ADDR A:0xa00f074
y.create.l HWIO_WCSS_A_RACTL_FFT_OPSCALE_ADDR A:0xa00f078
y.create.l HWIO_WCSS_A_RACTL_RACTL_STATE_ADDR A:0xa00f07c
y.create.l HWIO_WCSS_A_RACTL_AGC_ABORT_COUNT_ADDR A:0xa00f080
y.create.l HWIO_WCSS_A_RACTL_SIGNAL_INVALID_COUNT_LSIG_ADDR A:0xa00f084
y.create.l HWIO_WCSS_A_RACTL_SERV_INVALID_COUNT_ADDR A:0xa00f088
y.create.l HWIO_WCSS_A_RACTL_INTERRUPT_COUNT_ADDR A:0xa00f08c
y.create.l HWIO_WCSS_A_RACTL_LAST_LS_SIGNAL_ADDR A:0xa00f090
y.create.l HWIO_WCSS_A_RACTL_LAST_MS_SIGNAL_ADDR A:0xa00f094
y.create.l HWIO_WCSS_A_RACTL_LAST_MCS_ADDR A:0xa00f098
y.create.l HWIO_WCSS_A_RACTL_STROBE_UNSUPPHTSIG_ADDR A:0xa00f09c
y.create.l HWIO_WCSS_A_RACTL_LAST_UNSUPHTSIGNAL0_ADDR A:0xa00f0a0
y.create.l HWIO_WCSS_A_RACTL_LAST_UNSUPHTSIGNAL1_ADDR A:0xa00f0a4
y.create.l HWIO_WCSS_A_RACTL_LAST_UNSUPHTSIGNAL2_ADDR A:0xa00f0a8
y.create.l HWIO_WCSS_A_RACTL_LAST_MXED_SIG0_ADDR A:0xa00f0ac
y.create.l HWIO_WCSS_A_RACTL_LAST_MXED_SIG1_ADDR A:0xa00f0b0
y.create.l HWIO_WCSS_A_RACTL_LAST_MXED_SIG2_ADDR A:0xa00f0b4
y.create.l HWIO_WCSS_A_RACTL_STATISTICS_SELECT_ADDR A:0xa00f0b8
y.create.l HWIO_WCSS_A_RACTL_DAGC_TGTBO_ADDR A:0xa00f0bc
y.create.l HWIO_WCSS_A_RACTL_CMDWDFILL_ADDR A:0xa00f0c0
y.create.l HWIO_WCSS_A_RACTL_RACTL_STATUS_ADDR A:0xa00f0c4
y.create.l HWIO_WCSS_A_RACTL_NES2_MCSBOUND0_ADDR A:0xa00f0c8
y.create.l HWIO_WCSS_A_RACTL_NES2_MCSBOUND1_ADDR A:0xa00f0cc
y.create.l HWIO_WCSS_A_RACTL_NES2_MCSBOUND2_ADDR A:0xa00f0d0
y.create.l HWIO_WCSS_A_RACTL_NES2_MCSBOUND3_ADDR A:0xa00f0d4
y.create.l HWIO_WCSS_A_RACTL_LSIGLEN_LOWERBOUND_ADDR A:0xa00f0d8
y.create.l HWIO_WCSS_A_RACTL_RACTL_INTR_EN_ADDR A:0xa00f0dc
y.create.l HWIO_WCSS_A_RACTL_RACTL_SUPP_BWMISMCOUNT_ADDR A:0xa00f0e0
y.create.l HWIO_WCSS_A_RACTL_PTC_TH_ADDR A:0xa00f0e4
y.create.l HWIO_WCSS_A_RACTL_BWMISMCNTRST_ADDR A:0xa00f0e8
y.create.l HWIO_WCSS_A_RACTL_LMAP_OPSCALE1_SISO_ADDR A:0xa00f0f0
y.create.l HWIO_WCSS_A_RACTL_LMAP_OPSCALE2_SISO_ADDR A:0xa00f0f4
y.create.l HWIO_WCSS_A_RACTL_LMAP_OPSCALE1_STBC_ADDR A:0xa00f0f8
y.create.l HWIO_WCSS_A_RACTL_LMAP_OPSCALE2_STBC_ADDR A:0xa00f0fc
y.create.l HWIO_WCSS_A_RACTL_LMAP_OPSCALE3_ADDR A:0xa00f100
y.create.l HWIO_WCSS_A_RACTL_LMAP_TRK_CTRL_ADDR A:0xa00f104
y.create.l HWIO_WCSS_A_RACTL_LMAP_DUPCOMB_ADDR A:0xa00f108
y.create.l HWIO_WCSS_A_RACTL_LMAP_SNR_SEL_ADDR A:0xa00f10c
y.create.l HWIO_WCSS_A_RACTL_RACTL_SPL_ADDR A:0xa00f110
y.create.l HWIO_WCSS_A_RACTL_WATCHDOG1_ADDR A:0xa00f114
y.create.l HWIO_WCSS_A_RACTL_WATCHDOG2_ADDR A:0xa00f118
y.create.l HWIO_WCSS_A_RACTL_WATCHDOG3_ADDR A:0xa00f11c
y.create.l HWIO_WCSS_A_RACTL_RACTL_UNSUPP_BWMISMCOUNT_ADDR A:0xa00f120
y.create.l HWIO_WCSS_A_RACTL_RACTL_LAST_BW_ADDR A:0xa00f124
y.create.l HWIO_WCSS_A_RACTL_RACTL_MINSNRSTATS_ADDR A:0xa00f130
y.create.l HWIO_WCSS_A_RACTL_SIGNAL_INVALID_COUNT_HTSIG_ADDR A:0xa00f140
y.create.l HWIO_WCSS_A_RACTL_RXFIR_SCALING_COEFF_ADDR A:0xa00f144
y.create.l HWIO_WCSS_A_RACTL_CSI_CODEBOOK_SNR_TH_ADDR A:0xa00f148
y.create.l HWIO_WCSS_A_RACTL_CSI_CONFIG_ADDR A:0xa00f14c
y.create.l HWIO_WCSS_A_RACTL_BF_GAIN_DENOM_ADDR A:0xa00f150
y.create.l HWIO_WCSS_A_RACTL_CSI_STATS1_ADDR A:0xa00f154
y.create.l HWIO_WCSS_A_RACTL_CSI_STATS2_ADDR A:0xa00f158
y.create.l HWIO_WCSS_A_RACTL_CHE_SMOOTHING_ADDR A:0xa00f15c
y.create.l HWIO_WCSS_A_RACTL_PKTCNT_SMOOTHED_ADDR A:0xa00f160
y.create.l HWIO_WCSS_A_RACTL_RACTL_CRCCHKCFG_ADDR A:0xa00f164
y.create.l HWIO_WCSS_A_RACTL_RACTL_DBG_ADDR A:0xa00f168
y.create.l HWIO_WCSS_A_RACTL_FORCE_DBGPKTTYPE_ADDR A:0xa00f16c
y.create.l HWIO_WCSS_A_RACTL_RACTL_MU_ADDR A:0xa00f170
y.create.l HWIO_WCSS_A_RACTL_VIT_LSIG_ADDR A:0xa00f174
y.create.l HWIO_WCSS_A_RACTL_MCSFBSNRTH1_ADDR A:0xa00f180
y.create.l HWIO_WCSS_A_RACTL_MCSFBSNRTH2_ADDR A:0xa00f184
y.create.l HWIO_WCSS_A_RACTL_MCSFBSNRTH3_ADDR A:0xa00f188
y.create.l HWIO_WCSS_A_RACTL_MCSFBSNRTH4_ADDR A:0xa00f18c
y.create.l HWIO_WCSS_A_RACTL_MCSFBSNRTH5_ADDR A:0xa00f190
y.create.l HWIO_WCSS_A_RACTL_MCSFBSNRTH6_ADDR A:0xa00f194
y.create.l HWIO_WCSS_A_RACTL_MCSFBSNRTH7_ADDR A:0xa00f198
y.create.l HWIO_WCSS_A_RACTL_MCSFBSNRTH8_ADDR A:0xa00f19c
y.create.l HWIO_WCSS_A_RACTL_MCSFBSNRTH9_ADDR A:0xa00f1a0
y.create.l HWIO_WCSS_A_RACTL_MSA_REG0_ADDR A:0xa00f1a4
y.create.l HWIO_WCSS_A_RACTL_MSA_REG1_ADDR A:0xa00f1a8
y.create.l HWIO_WCSS_A_RACTL_MSA_REG2_ADDR A:0xa00f1ac
y.create.l HWIO_WCSS_A_RACTL_MSA_REG3_ADDR A:0xa00f1b0
y.create.l HWIO_WCSS_A_RACTL_UPA_REG0_ADDR A:0xa00f1b4
y.create.l HWIO_WCSS_A_RACTL_UPA_REG1_ADDR A:0xa00f1b8
y.create.l HWIO_WCSS_A_RACTL_UPA_REG2_ADDR A:0xa00f1bc
y.create.l HWIO_WCSS_A_RACTL_UPA_REG3_ADDR A:0xa00f1c0
y.create.l HWIO_WCSS_A_RACTL_UPA_REG4_ADDR A:0xa00f1c4
y.create.l HWIO_WCSS_A_RACTL_UPA_REG5_ADDR A:0xa00f1c8
y.create.l HWIO_WCSS_A_RACTL_UPA_REG6_ADDR A:0xa00f1cc
y.create.l HWIO_WCSS_A_RACTL_UPA_REG7_ADDR A:0xa00f1d0
y.create.l HWIO_WCSS_A_RBAPB_CONTROL_RXB_DSCR_ADDR A:0xa014400
y.create.l HWIO_WCSS_A_RBAPB_COUNT_SSFD_ADDR A:0xa014404
y.create.l HWIO_WCSS_A_RBAPB_COUNT_LSFD_ADDR A:0xa014408
y.create.l HWIO_WCSS_A_RBAPB_IGN_ILL_PLCP_ADDR A:0xa01440c
y.create.l HWIO_WCSS_A_RBAPB_COUNT_PLCP_CRC_ERRORS_ADDR A:0xa014410
y.create.l HWIO_WCSS_A_RBAPB_COUNT_PLCP_SIG_ERRORS_ADDR A:0xa014414
y.create.l HWIO_WCSS_A_RBAPB_COUNT_PLCP_SVC_ERRORS_ADDR A:0xa014418
y.create.l HWIO_WCSS_A_RBAPB_COUNT_RX_BYTES_ADDR A:0xa01441c
y.create.l HWIO_WCSS_A_RBAPB_COUNT_MPI_SOF_ADDR A:0xa014420
y.create.l HWIO_WCSS_A_RBAPB_COUNT_MPI_EOF_ADDR A:0xa014424
y.create.l HWIO_WCSS_A_RBAPB_SFD_DET_TMO_ADDR A:0xa014428
y.create.l HWIO_WCSS_A_RBAPB_SLR_SFD_DET_TMO_ADDR A:0xa01442c
y.create.l HWIO_WCSS_A_RBAPB_COUNT_RXB_START_ADDR A:0xa014430
y.create.l HWIO_WCSS_A_RBAPB_COUNT_RXB_ABORT_ADDR A:0xa014438
y.create.l HWIO_WCSS_A_RBAPB_RXB_RESET_ADDR A:0xa01443c
y.create.l HWIO_WCSS_A_RBAPB_CONTROL_BARKER_TIMING_TRACKING_ADDR A:0xa014440
y.create.l HWIO_WCSS_A_RBAPB_CMF_PLL_COEFF_A_ADDR A:0xa014448
y.create.l HWIO_WCSS_A_RBAPB_CMF_PLL_COEFF_B_ADDR A:0xa01444c
y.create.l HWIO_WCSS_A_RBAPB_CMF_PLL_COEFF_A_SLR_TRACK_ADDR A:0xa014450
y.create.l HWIO_WCSS_A_RBAPB_CMF_PLL_COEFF_B_SLR_TRACK_ADDR A:0xa014454
y.create.l HWIO_WCSS_A_RBAPB_ANTENNA_DIVERSITY_MODE_ADDR A:0xa014458
y.create.l HWIO_WCSS_A_RBAPB_SNR_THRESHOLD_ADDR A:0xa01445c
y.create.l HWIO_WCSS_A_RBAPB_SNR_AVERAGER_GAIN_ADDR A:0xa014460
y.create.l HWIO_WCSS_A_RBAPB_LMS_AVERAGER_SHIFT_ADDR A:0xa014464
y.create.l HWIO_WCSS_A_RBAPB_COUNT_DYNSEL_ANT0_ADDR A:0xa014468
y.create.l HWIO_WCSS_A_RBAPB_COUNT_DYNSEL_ANT1_ADDR A:0xa01446c
y.create.l HWIO_WCSS_A_RBAPB_COUNT_DYNSEL_2ANT_ADDR A:0xa014470
y.create.l HWIO_WCSS_A_RFIF_RF_BUS_CONTROL_ADDR A:0xa015000
y.create.l HWIO_WCSS_A_RFIF_RF_BUS_STATUS_ADDR A:0xa015004
y.create.l HWIO_WCSS_A_RFIF_ARB_CONTROL_ADDR A:0xa015008
y.create.l HWIO_WCSS_A_RFIF_ARB_COMMAND_ADDR A:0xa01500c
y.create.l HWIO_WCSS_A_RFIF_ARB_STATUS_ADDR A:0xa015010
y.create.l HWIO_WCSS_A_RFIF_BT_CTRL_CFG_ADDR A:0xa015014
y.create.l HWIO_WCSS_A_RFIF_TX_EN_CFG_ADDR A:0xa015018
y.create.l HWIO_WCSS_A_RFIF_RESET_CTRL_ADDR A:0xa01501c
y.create.l HWIO_WCSS_A_RFIF_PHY_HW_STATUS_ADDR A:0xa015020
y.create.l HWIO_WCSS_A_RFIF_RFAPB_STATUS_ADDR A:0xa015024
y.create.l HWIO_WCSS_A_RFIF_ERROR_CONDS_ADDR A:0xa015028
y.create.l HWIO_WCSS_A_RFIF_HKADC_RD_ADDR_ADDR A:0xa01502c
y.create.l HWIO_WCSS_A_RFIF_HKADC_WR_ADDR_ADDR A:0xa015030
y.create.l HWIO_WCSS_A_RFIF_HKADC_CONV_TIMER_ADDR A:0xa015034
y.create.l HWIO_WCSS_A_RFIF_RX_GAIN0_0_ADDR A:0xa015400
y.create.l HWIO_WCSS_A_RFIF_RX_GAIN1_0_ADDR A:0xa015410
y.create.l HWIO_WCSS_A_RFIF_RX_GAIN2_0_ADDR A:0xa015420
y.create.l HWIO_WCSS_A_RFIF_RX_GAIN3_0_ADDR A:0xa015430
y.create.l HWIO_WCSS_A_RFIF_RX_GAIN4_0_ADDR A:0xa015440
y.create.l HWIO_WCSS_A_RFIF_RX_GAIN5_0_ADDR A:0xa015450
y.create.l HWIO_WCSS_A_RFIF_RX_GAIN6_0_ADDR A:0xa015460
y.create.l HWIO_WCSS_A_RFIF_RX_GAIN7_0_ADDR A:0xa015470
y.create.l HWIO_WCSS_A_RFIF_RX_GAIN8_0_ADDR A:0xa015480
y.create.l HWIO_WCSS_A_RFIF_RX_GAIN9_0_ADDR A:0xa015490
y.create.l HWIO_WCSS_A_RFIF_RX_GAIN0_1_ADDR A:0xa015404
y.create.l HWIO_WCSS_A_RFIF_RX_GAIN1_1_ADDR A:0xa015414
y.create.l HWIO_WCSS_A_RFIF_RX_GAIN2_1_ADDR A:0xa015424
y.create.l HWIO_WCSS_A_RFIF_RX_GAIN3_1_ADDR A:0xa015434
y.create.l HWIO_WCSS_A_RFIF_RX_GAIN4_1_ADDR A:0xa015444
y.create.l HWIO_WCSS_A_RFIF_RX_GAIN5_1_ADDR A:0xa015454
y.create.l HWIO_WCSS_A_RFIF_RX_GAIN6_1_ADDR A:0xa015464
y.create.l HWIO_WCSS_A_RFIF_RX_GAIN7_1_ADDR A:0xa015474
y.create.l HWIO_WCSS_A_RFIF_RX_GAIN8_1_ADDR A:0xa015484
y.create.l HWIO_WCSS_A_RFIF_RX_GAIN9_1_ADDR A:0xa015494
y.create.l HWIO_WCSS_A_RFIF_RX_GAIN0_2_ADDR A:0xa015408
y.create.l HWIO_WCSS_A_RFIF_RX_GAIN1_2_ADDR A:0xa015418
y.create.l HWIO_WCSS_A_RFIF_RX_GAIN2_2_ADDR A:0xa015428
y.create.l HWIO_WCSS_A_RFIF_RX_GAIN3_2_ADDR A:0xa015438
y.create.l HWIO_WCSS_A_RFIF_RX_GAIN4_2_ADDR A:0xa015448
y.create.l HWIO_WCSS_A_RFIF_RX_GAIN5_2_ADDR A:0xa015458
y.create.l HWIO_WCSS_A_RFIF_RX_GAIN6_2_ADDR A:0xa015468
y.create.l HWIO_WCSS_A_RFIF_RX_GAIN7_2_ADDR A:0xa015478
y.create.l HWIO_WCSS_A_RFIF_RX_GAIN8_2_ADDR A:0xa015488
y.create.l HWIO_WCSS_A_RFIF_RX_GAIN9_2_ADDR A:0xa015498
y.create.l HWIO_WCSS_A_RFIF_TX_GAIN0_0_ADDR A:0xa015800
y.create.l HWIO_WCSS_A_RFIF_TX_GAIN1_0_ADDR A:0xa015820
y.create.l HWIO_WCSS_A_RFIF_TX_GAIN2_0_ADDR A:0xa015840
y.create.l HWIO_WCSS_A_RFIF_TX_GAIN3_0_ADDR A:0xa015860
y.create.l HWIO_WCSS_A_RFIF_TX_GAIN4_0_ADDR A:0xa015880
y.create.l HWIO_WCSS_A_RFIF_TX_GAIN5_0_ADDR A:0xa0158a0
y.create.l HWIO_WCSS_A_RFIF_TX_GAIN6_0_ADDR A:0xa0158c0
y.create.l HWIO_WCSS_A_RFIF_TX_GAIN7_0_ADDR A:0xa0158e0
y.create.l HWIO_WCSS_A_RFIF_TX_GAIN8_0_ADDR A:0xa015900
y.create.l HWIO_WCSS_A_RFIF_TX_GAIN9_0_ADDR A:0xa015920
y.create.l HWIO_WCSS_A_RFIF_TX_GAIN0_1_ADDR A:0xa015804
y.create.l HWIO_WCSS_A_RFIF_TX_GAIN1_1_ADDR A:0xa015824
y.create.l HWIO_WCSS_A_RFIF_TX_GAIN2_1_ADDR A:0xa015844
y.create.l HWIO_WCSS_A_RFIF_TX_GAIN3_1_ADDR A:0xa015864
y.create.l HWIO_WCSS_A_RFIF_TX_GAIN4_1_ADDR A:0xa015884
y.create.l HWIO_WCSS_A_RFIF_TX_GAIN5_1_ADDR A:0xa0158a4
y.create.l HWIO_WCSS_A_RFIF_TX_GAIN6_1_ADDR A:0xa0158c4
y.create.l HWIO_WCSS_A_RFIF_TX_GAIN7_1_ADDR A:0xa0158e4
y.create.l HWIO_WCSS_A_RFIF_TX_GAIN8_1_ADDR A:0xa015904
y.create.l HWIO_WCSS_A_RFIF_TX_GAIN9_1_ADDR A:0xa015924
y.create.l HWIO_WCSS_A_RFIF_TX_GAIN0_2_ADDR A:0xa015808
y.create.l HWIO_WCSS_A_RFIF_TX_GAIN1_2_ADDR A:0xa015828
y.create.l HWIO_WCSS_A_RFIF_TX_GAIN2_2_ADDR A:0xa015848
y.create.l HWIO_WCSS_A_RFIF_TX_GAIN3_2_ADDR A:0xa015868
y.create.l HWIO_WCSS_A_RFIF_TX_GAIN4_2_ADDR A:0xa015888
y.create.l HWIO_WCSS_A_RFIF_TX_GAIN5_2_ADDR A:0xa0158a8
y.create.l HWIO_WCSS_A_RFIF_TX_GAIN6_2_ADDR A:0xa0158c8
y.create.l HWIO_WCSS_A_RFIF_TX_GAIN7_2_ADDR A:0xa0158e8
y.create.l HWIO_WCSS_A_RFIF_TX_GAIN8_2_ADDR A:0xa015908
y.create.l HWIO_WCSS_A_RFIF_TX_GAIN9_2_ADDR A:0xa015928
y.create.l HWIO_WCSS_A_RFIF_TX_GAIN0_3_ADDR A:0xa01580c
y.create.l HWIO_WCSS_A_RFIF_TX_GAIN1_3_ADDR A:0xa01582c
y.create.l HWIO_WCSS_A_RFIF_TX_GAIN2_3_ADDR A:0xa01584c
y.create.l HWIO_WCSS_A_RFIF_TX_GAIN3_3_ADDR A:0xa01586c
y.create.l HWIO_WCSS_A_RFIF_TX_GAIN4_3_ADDR A:0xa01588c
y.create.l HWIO_WCSS_A_RFIF_TX_GAIN5_3_ADDR A:0xa0158ac
y.create.l HWIO_WCSS_A_RFIF_TX_GAIN6_3_ADDR A:0xa0158cc
y.create.l HWIO_WCSS_A_RFIF_TX_GAIN7_3_ADDR A:0xa0158ec
y.create.l HWIO_WCSS_A_RFIF_TX_GAIN8_3_ADDR A:0xa01590c
y.create.l HWIO_WCSS_A_RFIF_TX_GAIN9_3_ADDR A:0xa01592c
y.create.l HWIO_WCSS_A_RFIF_TX_GAIN0_4_ADDR A:0xa015810
y.create.l HWIO_WCSS_A_RFIF_TX_GAIN1_4_ADDR A:0xa015830
y.create.l HWIO_WCSS_A_RFIF_TX_GAIN2_4_ADDR A:0xa015850
y.create.l HWIO_WCSS_A_RFIF_TX_GAIN3_4_ADDR A:0xa015870
y.create.l HWIO_WCSS_A_RFIF_TX_GAIN4_4_ADDR A:0xa015890
y.create.l HWIO_WCSS_A_RFIF_TX_GAIN5_4_ADDR A:0xa0158b0
y.create.l HWIO_WCSS_A_RFIF_TX_GAIN6_4_ADDR A:0xa0158d0
y.create.l HWIO_WCSS_A_RFIF_TX_GAIN7_4_ADDR A:0xa0158f0
y.create.l HWIO_WCSS_A_RFIF_TX_GAIN8_4_ADDR A:0xa015910
y.create.l HWIO_WCSS_A_RFIF_TX_GAIN9_4_ADDR A:0xa015930
y.create.l HWIO_WCSS_A_RFIF_TX_GAIN0_5_ADDR A:0xa015814
y.create.l HWIO_WCSS_A_RFIF_TX_GAIN1_5_ADDR A:0xa015834
y.create.l HWIO_WCSS_A_RFIF_TX_GAIN2_5_ADDR A:0xa015854
y.create.l HWIO_WCSS_A_RFIF_TX_GAIN3_5_ADDR A:0xa015874
y.create.l HWIO_WCSS_A_RFIF_TX_GAIN4_5_ADDR A:0xa015894
y.create.l HWIO_WCSS_A_RFIF_TX_GAIN5_5_ADDR A:0xa0158b4
y.create.l HWIO_WCSS_A_RFIF_TX_GAIN6_5_ADDR A:0xa0158d4
y.create.l HWIO_WCSS_A_RFIF_TX_GAIN7_5_ADDR A:0xa0158f4
y.create.l HWIO_WCSS_A_RFIF_TX_GAIN8_5_ADDR A:0xa015914
y.create.l HWIO_WCSS_A_RFIF_TX_GAIN9_5_ADDR A:0xa015934
y.create.l HWIO_WCSS_A_RPE_MEM_BASE_ADDR_ADDR A:0xa082400
y.create.l HWIO_WCSS_A_RPE_FULLSTATE_STATIONS_QUEUES_ADDR A:0xa082404
y.create.l HWIO_WCSS_A_RPE_SM_STUCK_CNT_VALUE_ADDR A:0xa082408
y.create.l HWIO_WCSS_A_RPE_RPE_CONFIG_ADDR A:0xa08240c
y.create.l HWIO_WCSS_A_RPE_ROUTING_FLAG_ADDR A:0xa082410
y.create.l HWIO_WCSS_A_RPE_SW_FLUSH_BITMAP_CACHE_ADDR A:0xa082414
y.create.l HWIO_WCSS_A_RPE_FULLSTATE_BITMAP_CACHE_DW1_ADDR A:0xa082418
y.create.l HWIO_WCSS_A_RPE_FULLSTATE_BITMAP_CACHE_DW2_ADDR A:0xa08241c
y.create.l HWIO_WCSS_A_RPE_FULLSTATE_BITMAP_CACHE_DW3_ADDR A:0xa082420
y.create.l HWIO_WCSS_A_RPE_STATIONID_QID_4_FULLSTATE_BITMAP_ADDR A:0xa082424
y.create.l HWIO_WCSS_A_RPE_PARTIALSTATE_BITMAP_CACHE_DW1_ADDR A:0xa082428
y.create.l HWIO_WCSS_A_RPE_PARTIALSTATE_BITMAP_CACHE_DW2_ADDR A:0xa08242c
y.create.l HWIO_WCSS_A_RPE_PARTIALSTATE_BITMAP_CACHE_DW3_ADDR A:0xa082430
y.create.l HWIO_WCSS_A_RPE_STATIONID_QID_4_PARTIALSTATE_BITMAP_ADDR A:0xa082434
y.create.l HWIO_WCSS_A_RPE_FRAGMENT_RESRC_ENTRY1_DW1_ADDR A:0xa082438
y.create.l HWIO_WCSS_A_RPE_FRAGMENT_RESRC_ENTRY1_DW2_ADDR A:0xa08243c
y.create.l HWIO_WCSS_A_RPE_FRAGMENT_RESRC_ENTRY2_DW1_ADDR A:0xa082440
y.create.l HWIO_WCSS_A_RPE_FRAGMENT_RESRC_ENTRY2_DW2_ADDR A:0xa082444
y.create.l HWIO_WCSS_A_RPE_ERR_INT_ENABLE_ADDR A:0xa082478
y.create.l HWIO_WCSS_A_RPE_ERR_INT_STATUS_ADDR A:0xa08247c
y.create.l HWIO_WCSS_A_RPE_CUR_STATE_BU_DD_ADDR A:0xa082480
y.create.l HWIO_WCSS_A_RPE_CUR_STATE_RA_RR_ADDR A:0xa082484
y.create.l HWIO_WCSS_A_RPE_CUR_STATE_DMA_ADDR A:0xa082488
y.create.l HWIO_WCSS_A_RPE_SEND_PKT_STATS_ADDR A:0xa08248c
y.create.l HWIO_WCSS_A_RPE_DROP_PKT_STATS_ADDR A:0xa082490
y.create.l HWIO_WCSS_A_RPE_GET_BMU_FAIL_STATS_ADDR A:0xa082494
y.create.l HWIO_WCSS_A_RPE_RPE_TESTBUS_LOWER_ADDR A:0xa082498
y.create.l HWIO_WCSS_A_RPE_RPE_TESTBUS_UPPER_ADDR A:0xa08249c
y.create.l HWIO_WCSS_A_RPE_RPE_BITMAP_DUPLICATE_CNTR_ADDR A:0xa082500
y.create.l HWIO_WCSS_A_RPE_RPE_SW_FLUSH_RSRC_ENTRY_ADDR A:0xa082504
y.create.l HWIO_WCSS_A_RPE_RPE_SW_BLOCK_PKTS_ADDR A:0xa082508
y.create.l HWIO_WCSS_A_RPE_REORDER_BITMAP_CACHE_DW1_ADDR A:0xa08250c
y.create.l HWIO_WCSS_A_RPE_REORDER_BITMAP_CACHE_DW2_ADDR A:0xa082510
y.create.l HWIO_WCSS_A_RPE_REORDER_BITMAP_CACHE_DW3_ADDR A:0xa082514
y.create.l HWIO_WCSS_A_RPE_SPARE_AND_CLK_GATE_DISABLE_ADDR A:0xa082550
y.create.l HWIO_WCSS_A_RXACLKCTRL_ROOT_CLK_EN_ADDR A:0xa016000
y.create.l HWIO_WCSS_A_RXACLKCTRL_APB_BLOCK_CLK_EN_ADDR A:0xa016004
y.create.l HWIO_WCSS_A_RXACLKCTRL_APB_BLOCK_DYN_CLKG_DISABLE_ADDR A:0xa016008
y.create.l HWIO_WCSS_A_RXACLKCTRL_DYN_ANTSW_CLK_CTRL_DISABLE_ADDR A:0xa01600c
y.create.l HWIO_WCSS_A_RXACLKCTRL_MAIN1_FAST_CLK_CTRL_ADDR A:0xa016010
y.create.l HWIO_WCSS_A_RXCLKCTRL_ROOT_CLK_EN_ADDR A:0xa016400
y.create.l HWIO_WCSS_A_RXCLKCTRL_APB_BLOCK_CLK_EN_ADDR A:0xa016404
y.create.l HWIO_WCSS_A_RXCLKCTRL_APB_BLOCK_DYN_CLKG_DISABLE_ADDR A:0xa016408
y.create.l HWIO_WCSS_A_RXCLKCTRL_APB_BLOCK_DYN_CLKG_DISABLE_AGC_ADDR A:0xa01640c
y.create.l HWIO_WCSS_A_RXCLKCTRL_APB_SYNC_RESET_ADDR A:0xa016410
y.create.l HWIO_WCSS_A_RXCLKCTRL_CLK_PHY_MAIN2_3BY4_DIV_BYPASS_ADDR A:0xa016414
y.create.l HWIO_WCSS_A_RXCLKCTRL_BW_CONFIG_ADDR A:0xa016418
y.create.l HWIO_WCSS_A_RXCLKCTRL_PHY_VERSION_ADDR A:0xa016420
y.create.l HWIO_WCSS_A_RXCLKCTRL_FAST_CH_SW_PAGE_SEL_ADDR A:0xa016424
y.create.l HWIO_WCSS_A_RXCLKCTRL_ADC_FIFO_SYNC_RST_ADDR A:0xa016428
y.create.l HWIO_WCSS_A_RXP_CONFIG_ADDR A:0xa080800
y.create.l HWIO_WCSS_A_RXP_MAX_PKTLEN_ADDR A:0xa080808
y.create.l HWIO_WCSS_A_RXP_SW_BD_REG_ADDR A:0xa08080c
y.create.l HWIO_WCSS_A_RXP_MPDU_HEADER_START_OFFSET_ADDR A:0xa080810
y.create.l HWIO_WCSS_A_RXP_SEARCH_ADDR1_PTR_ADDR A:0xa08082c
y.create.l HWIO_WCSS_A_RXP_SEARCH_ADDR2_PTR_ADDR A:0xa080830
y.create.l HWIO_WCSS_A_RXP_SEARCH_ADDR3_PTR_ADDR A:0xa080834
y.create.l HWIO_WCSS_A_RXP_SEARCH_TABLE_CMD_ADDR A:0xa080838
y.create.l HWIO_WCSS_A_RXP_SEARCH_TABLE_DATA0_ADDR A:0xa08083c
y.create.l HWIO_WCSS_A_RXP_SEARCH_TABLE_DATA1_ADDR A:0xa080840
y.create.l HWIO_WCSS_A_RXP_MAX_LEN_AMPDU_ADDR A:0xa080844
y.create.l HWIO_WCSS_A_RXP_MAX_LEN_MPDU_IN_AMPDU_ADDR A:0xa080848
y.create.l HWIO_WCSS_A_RXP_DMA_MAX_RSV_PDU_ADDR A:0xa08084c
y.create.l HWIO_WCSS_A_RXP_DMA_BURST_THRESHOLD_ADDR A:0xa080850
y.create.l HWIO_WCSS_A_RXP_CLEAR_STATS_ADDR A:0xa080854
y.create.l HWIO_WCSS_A_RXP_PHY_MPDU_CNT_ADDR A:0xa080858
y.create.l HWIO_WCSS_A_RXP_PHY_AMPDU_CNT_ADDR A:0xa08085c
y.create.l HWIO_WCSS_A_RXP_PHY_ABORT_CNT_ADDR A:0xa080864
y.create.l HWIO_WCSS_A_RXP_PHY_SHUTOFF_CNT_ADDR A:0xa080868
y.create.l HWIO_WCSS_A_RXP_DLM_FIFO_FULL_CNT_ADDR A:0xa08086c
y.create.l HWIO_WCSS_A_RXP_DLM_ERR_CNT_ADDR A:0xa080870
y.create.l HWIO_WCSS_A_RXP_FAIL_FILTER_CNT_ADDR A:0xa080874
y.create.l HWIO_WCSS_A_RXP_FAIL_MAX_PKTLEN_CNT_ADDR A:0xa080878
y.create.l HWIO_WCSS_A_RXP_FCS_ERR_CNT_ADDR A:0xa08087c
y.create.l HWIO_WCSS_A_RXP_DMA_SEND_CNT_ADDR A:0xa080880
y.create.l HWIO_WCSS_A_RXP_DMA_DROP_CNT_ADDR A:0xa080884
y.create.l HWIO_WCSS_A_RXP_DMA_GET_BMU_FAIL_CNT_ADDR A:0xa080888
y.create.l HWIO_WCSS_A_RXP_PROTOCOL_VERSION_FILTER_CNT_ADDR A:0xa08088c
y.create.l HWIO_WCSS_A_RXP_TYPE_SUBTYPE_FILTER_CNT_ADDR A:0xa080890
y.create.l HWIO_WCSS_A_RXP_INCORRECT_LENGTH_FILTER_CNT_ADDR A:0xa080894
y.create.l HWIO_WCSS_A_RXP_ADDR1_BLOCK_FILTER_CNT_ADDR A:0xa080898
y.create.l HWIO_WCSS_A_RXP_ADDR1_HIT_NO_PASS_CNT_ADDR A:0xa08089c
y.create.l HWIO_WCSS_A_RXP_ADDR1_DROP_CNT_ADDR A:0xa0808a0
y.create.l HWIO_WCSS_A_RXP_ADDR2_HIT_NO_PASS_CNT_ADDR A:0xa0808a4
y.create.l HWIO_WCSS_A_RXP_ADDR2_DROP_CNT_ADDR A:0xa0808a8
y.create.l HWIO_WCSS_A_RXP_ADDR3_HIT_NO_PASS_CNT_ADDR A:0xa0808ac
y.create.l HWIO_WCSS_A_RXP_ADDR3_DROP_CNT_ADDR A:0xa0808b0
y.create.l HWIO_WCSS_A_RXP_MPDU_IN_AMPDU_CNT_ADDR A:0xa0808b4
y.create.l HWIO_WCSS_A_RXP_PHY_ERR_DROP_CNT_ADDR A:0xa0808b8
y.create.l HWIO_WCSS_A_RXP_RADAR_DETECT_STATUS_ADDR A:0xa0808bc
y.create.l HWIO_WCSS_A_RXP_RADAR_DETECT_CONTROL_ADDR A:0xa0808c0
y.create.l HWIO_WCSS_A_RXP_RADAR_DETECT_LLOGS_ADDR A:0xa0808c4
y.create.l HWIO_WCSS_A_RXP_RADAR_DETECT_ULOGS_ADDR A:0xa0808c8
y.create.l HWIO_WCSS_A_RXP_RADAR_DETECT_LOGS_ADDR A:0xa0808cc
y.create.l HWIO_WCSS_A_RXP_SOFT_PMI_ABORT_ADDR A:0xa0808d0
y.create.l HWIO_WCSS_A_RXP_START_ERR_CNT_ADDR A:0xa0808d4
y.create.l HWIO_WCSS_A_RXP_CCA_AND_EXT_TIMEOUT_ADDR A:0xa0808d8
y.create.l HWIO_WCSS_A_RXP_TIMEOUT_ERROR_CNT_ADDR A:0xa0808dc
y.create.l HWIO_WCSS_A_RXP_STALL_TIMEOUT_CNT_ADDR A:0xa0808e0
y.create.l HWIO_WCSS_A_RXP_CFG_FLT_NAV_CONTROL_RESPONSE_REQ_ADDR A:0xa0808ec
y.create.l HWIO_WCSS_A_RXP_CFG_FLT_TYPE_SUBTYPE_RX_DISABLE0_ADDR A:0xa0808f0
y.create.l HWIO_WCSS_A_RXP_CFG_FLT_TYPE_SUBTYPE_RX_DISABLE1_ADDR A:0xa0808f4
y.create.l HWIO_WCSS_A_RXP_DIAG_STATUS_ADDR A:0xa0808f8
y.create.l HWIO_WCSS_A_RXP_DIAG_TESTBUS_SEL_ADDR A:0xa0808fc
y.create.l HWIO_WCSS_A_RXP_FRAME_FILTER_CONFIG_ADDR A:0xa080900
y.create.l HWIO_WCSS_A_RXP_STALL_TIMEOUT_ADDR A:0xa080a04
y.create.l HWIO_WCSS_A_RXP_MAX_LEN_AMSDU_ADDR A:0xa080a40
y.create.l HWIO_WCSS_A_RXP_FAIL_MAX_PKTLEN_AMSDU_CNT_ADDR A:0xa080a44
y.create.l HWIO_WCSS_A_RXP_CONFIG2_ADDR A:0xa080a50
y.create.l HWIO_WCSS_A_RXP_CONFIG3_ADDR A:0xa080a54
y.create.l HWIO_WCSS_A_RXP_SEARCH_TABLE_DATA2_ADDR A:0xa080a58
y.create.l HWIO_WCSS_A_RXP_BEACON_TSF_TIM_EXTRACT_CTRL_ADDR A:0xa080a5c
y.create.l HWIO_WCSS_A_RXP_TSF_COMPENSATION1_VALUE_ADDR A:0xa080a60
y.create.l HWIO_WCSS_A_RXP_TSF_COMPENSATION2_VALUE_ADDR A:0xa080a64
y.create.l HWIO_WCSS_A_RXP_SSID_VALUES_B0_B3_ADDR A:0xa080a68
y.create.l HWIO_WCSS_A_RXP_SSID_VALUES_B4_B7_ADDR A:0xa080a6c
y.create.l HWIO_WCSS_A_RXP_SSID_VALUES_B8_B11_ADDR A:0xa080a70
y.create.l HWIO_WCSS_A_RXP_SSID_VALUES_B12_B15_ADDR A:0xa080a74
y.create.l HWIO_WCSS_A_RXP_SSID_VALUES_B16_B19_ADDR A:0xa080a78
y.create.l HWIO_WCSS_A_RXP_SSID_VALUES_B20_B23_ADDR A:0xa080a7c
y.create.l HWIO_WCSS_A_RXP_SSID_VALUES_B24_B27_ADDR A:0xa080a80
y.create.l HWIO_WCSS_A_RXP_SSID_VALUES_B28_B31_ADDR A:0xa080a84
y.create.l HWIO_WCSS_A_RXP_BEACON_ADDR2_LOW_FIELD_ADDR A:0xa080a88
y.create.l HWIO_WCSS_A_RXP_BEACON_ADDR2_HIGH_FIELD_ADDR A:0xa080a8c
y.create.l HWIO_WCSS_A_RXP_BEACON_ADDR3_LOW_FIELD_ADDR A:0xa080a90
y.create.l HWIO_WCSS_A_RXP_BEACON_ADDR3_HIGH_FIELD_ADDR A:0xa080a94
y.create.l HWIO_WCSS_A_RXP_FLT_DUPL_CNT_ADDR A:0xa080a98
y.create.l HWIO_WCSS_A_RXP_FLT_RPE_HANDSHAKE_TIMEOUT_CNT_ADDR A:0xa080a9c
y.create.l HWIO_WCSS_A_RXP_QID_MAPPING0_ADDR A:0xa080b00
y.create.l HWIO_WCSS_A_RXP_QID_MAPPING1_ADDR A:0xa080b04
y.create.l HWIO_WCSS_A_RXP_QID_MAPPING2_ADDR A:0xa080b08
y.create.l HWIO_WCSS_A_RXP_QID_MAPPING3_ADDR A:0xa080b0c
y.create.l HWIO_WCSS_A_RXP_QID_MAPPING4_ADDR A:0xa080b10
y.create.l HWIO_WCSS_A_RXP_PUSH_WQ_CTRL_ADDR A:0xa080b14
y.create.l HWIO_WCSS_A_RXP_PUSH_WQ_CTRL2_ADDR A:0xa080b18
y.create.l HWIO_WCSS_A_RXP_EXTRA_FRAME_FILTER_CONTROL_ADDR A:0xa080b1c
y.create.l HWIO_WCSS_A_RXP_RXP_GROUPED_INTERRUPT_ENABLE_ADDR A:0xa080b20
y.create.l HWIO_WCSS_A_RXP_RXP_GROUPED_INTERRUPT_STATUS_ADDR A:0xa080b24
y.create.l HWIO_WCSS_A_RXP_DEFAULT_HW_INSERT_DPU_PARAM_ADDR A:0xa080b28
y.create.l HWIO_WCSS_A_RXP_PSPOLL_NAV_VALUE_ADDR A:0xa080b44
y.create.l HWIO_WCSS_A_RXP_PMU_INTERFACE_CONTROL_ADDR A:0xa080b48
y.create.l HWIO_WCSS_A_RXP_RATE_INDEX_HISTORY_ADDR A:0xa080b50
y.create.l HWIO_WCSS_A_RXP_ADDR2_MISS_INFO_ADDR A:0xa080b58
y.create.l HWIO_WCSS_A_RXP_ADDR2_MISS_CTRL_ADDR A:0xa080b5c
y.create.l HWIO_WCSS_A_RXP_EOSP_INT_CONTROL_ADDR A:0xa080b60
y.create.l HWIO_WCSS_A_RXP_MORE_DATA_CLEAR_INT_CONTROL_ADDR A:0xa080b64
y.create.l HWIO_WCSS_A_RXP_CONFIG4_ADDR A:0xa080b6c
y.create.l HWIO_WCSS_A_RXP_BEACON_P2P_CLIENT_ADDR_LOW_FIELD_ADDR A:0xa080b74
y.create.l HWIO_WCSS_A_RXP_BEACON_P2P_CLIENT_ADDR_HIGH_FIELD_ADDR A:0xa080b78
y.create.l HWIO_WCSS_A_RXP_P2P_BEACON_PARSE_CONTROL_ADDR A:0xa080b7c
y.create.l HWIO_WCSS_A_RXP_MORE_DATA_SET_INT_CONTROL_ADDR A:0xa080b80
y.create.l HWIO_WCSS_A_RXP_RULE1_CNTR_CTRL_ADDR A:0xa080b84
y.create.l HWIO_WCSS_A_RXP_RULE2_CNTR_CTRL_ADDR A:0xa080b88
y.create.l HWIO_WCSS_A_RXP_RULE1_CNTR_ADDR A:0xa080b8c
y.create.l HWIO_WCSS_A_RXP_RULE2_CNTR_ADDR A:0xa080b90
y.create.l HWIO_WCSS_A_RXP_DROP_DUE_TO_DROP_AT_DMA_CNT_ADDR A:0xa080b94
y.create.l HWIO_WCSS_A_RXP_RX_TIME_CNTR_ADDR A:0xa080b98
y.create.l HWIO_WCSS_A_RXP_SPARE_AND_CLKGATE_DIS_ADDR A:0xa080b9c
y.create.l HWIO_WCSS_A_RXP_NDP_PKT_CNTR_ADDR A:0xa080ba0
y.create.l HWIO_WCSS_A_RXP_P2P_BEACON_PARSE_CONTROL2_ADDR A:0xa080ba4
y.create.l HWIO_WCSS_A_RXP_BSS2_BEACON_PARSE_CONTROL_ADDR A:0xa080ba8
y.create.l HWIO_WCSS_A_RXP_BEACON_BSS2_ADDR_LOW_FIELD_ADDR A:0xa080bac
y.create.l HWIO_WCSS_A_RXP_BEACON_BSS2_CLIENT_ADDR_HIGH_FIELD_ADDR A:0xa080bb0
y.create.l HWIO_WCSS_A_RXP_RXP_GROUPED2_INTERRUPT_ENABLE_ADDR A:0xa080bb4
y.create.l HWIO_WCSS_A_RXP_RXP_GROUPED2_INTERRUPT_STATUS_ADDR A:0xa080bb8
y.create.l HWIO_WCSS_A_RXP_RXP_QBOOST_CONTROL_ADDR A:0xa080bbc
y.create.l HWIO_WCSS_A_RXP_RXP_P2P_CHANNELSWITCH_BODY_ADDR A:0xa080bc0
y.create.l HWIO_WCSS_A_RXP_RXP_BSS_CHANNELSWITCH_BODY_ADDR A:0xa080bc4
y.create.l HWIO_WCSS_A_RXP_RXP_BSS2_CHANNELSWITCH_BODY_ADDR A:0xa080bc8
y.create.l HWIO_WCSS_A_RXP_RXP_P2P_QUIETIE_LSBYTES_ADDR A:0xa080bcc
y.create.l HWIO_WCSS_A_RXP_RXP_BSS_QUIETIE_LSBYTES_ADDR A:0xa080bd0
y.create.l HWIO_WCSS_A_RXP_RXP_BSS2_QUIETIE_LSBYTES_ADDR A:0xa080bd4
y.create.l HWIO_WCSS_A_RXP_RXP_P2P_QUIETIE_MSBYTES_ADDR A:0xa080bd8
y.create.l HWIO_WCSS_A_RXP_RXP_BSS_QUIETIE_MSBYTES_ADDR A:0xa080bdc
y.create.l HWIO_WCSS_A_RXP_RXP_BSS2_QUIETIE_MSBYTES_ADDR A:0xa080be0
y.create.l HWIO_WCSS_A_TACTL_CFG_ADDR A:0xa012400
y.create.l HWIO_WCSS_A_TACTL_SCR_CONFIG_ADDR A:0xa012404
y.create.l HWIO_WCSS_A_TACTL_TATMUX_CONFIG_ADDR A:0xa012408
y.create.l HWIO_WCSS_A_TACTL_SCALE_20_ADDR A:0xa01240c
y.create.l HWIO_WCSS_A_TACTL_SCALE_40_ADDR A:0xa012410
y.create.l HWIO_WCSS_A_TACTL_SCALE_80_ADDR A:0xa012414
y.create.l HWIO_WCSS_A_TACTL_CYC_DELAY_11AC_ADDR A:0xa012418
y.create.l HWIO_WCSS_A_TACTL_DOT11AC_SERVICE_OVERRIDE_ADDR A:0xa01241c
y.create.l HWIO_WCSS_A_TACTL_DOT11AC_APB_SERVICE_ADDR A:0xa012420
y.create.l HWIO_WCSS_A_TACTL_DOT11AC_MU_MIMO_NSTS_OVERRIDE_ADDR A:0xa012424
y.create.l HWIO_WCSS_A_TACTL_CTRL_STATE_ADDR A:0xa012428
y.create.l HWIO_WCSS_A_TACTL_PKT_REQ_COUNT_ADDR A:0xa01242c
y.create.l HWIO_WCSS_A_TACTL_TAHDR_SYM_COUNT_ADDR A:0xa012430
y.create.l HWIO_WCSS_A_TACTL_TAQAM_SYM_COUNT_ADDR A:0xa012434
y.create.l HWIO_WCSS_A_TACTL_LAST_SYM_PARAMS_ADDR A:0xa012438
y.create.l HWIO_WCSS_A_TACTL_QAM_NSYMS_ADDR A:0xa01243c
y.create.l HWIO_WCSS_A_TACTL_NPKTS_ADDR A:0xa012440
y.create.l HWIO_WCSS_A_TACTL_SCR_LFSR_ADDR A:0xa012444
y.create.l HWIO_WCSS_A_TACTL_ALARMS_ADDR A:0xa012448
y.create.l HWIO_WCSS_A_TACTL_RESET_ALARMS_ADDR A:0xa01244c
y.create.l HWIO_WCSS_A_TACTL_LAST_MU_PARAMS_ADDR A:0xa012450
y.create.l HWIO_WCSS_A_TACTL_MU_PKT_ADDR A:0xa012454
y.create.l HWIO_WCSS_A_TACTL_DISABLE_MAC_LSIG_ADDR A:0xa012458
y.create.l HWIO_WCSS_A_TAQAM_SCALE_BPSK_ADDR A:0xa012c00
y.create.l HWIO_WCSS_A_TAQAM_SCALE_QPSK_ADDR A:0xa012c08
y.create.l HWIO_WCSS_A_TAQAM_SCALE_QAM16_ADDR A:0xa012c0c
y.create.l HWIO_WCSS_A_TAQAM_SCALE_QAM64_ADDR A:0xa012c10
y.create.l HWIO_WCSS_A_TAQAM_SCALE_QAM256_ADDR A:0xa012c14
y.create.l HWIO_WCSS_A_TAQAM_SCALE_LEGACY20_ADDR A:0xa012c18
y.create.l HWIO_WCSS_A_TAQAM_SCALE_LEGACY40_ADDR A:0xa012c1c
y.create.l HWIO_WCSS_A_TAQAM_SCALE_LEGACY80_ADDR A:0xa012c20
y.create.l HWIO_WCSS_A_TAQAM_SCALE_HT20_ADDR A:0xa012c24
y.create.l HWIO_WCSS_A_TAQAM_SCALE_HT40_ADDR A:0xa012c28
y.create.l HWIO_WCSS_A_TAQAM_SCALE_HT80_ADDR A:0xa012c2c
y.create.l HWIO_WCSS_A_TAQAM_AC_ADDR A:0xa012c30
y.create.l HWIO_WCSS_A_TBAPB_CRC16_CTRL_ADDR A:0xa012800
y.create.l HWIO_WCSS_A_TBAPB_SCRAMBLE_CTRL_ADDR A:0xa012804
y.create.l HWIO_WCSS_A_TBAPB_TXB_DEBUG_ADDR A:0xa012808
y.create.l HWIO_WCSS_A_TBAPB_LINEAR_DELAY_ANT1_ADDR A:0xa01280c
y.create.l HWIO_WCSS_A_TBAPB_LINEAR_DELAY_ANT2_ADDR A:0xa012810
y.create.l HWIO_WCSS_A_TBAPB_LINEAR_DELAY_ANT3_ADDR A:0xa012814
y.create.l HWIO_WCSS_A_TDC_TDCSYM_IN_ADDR A:0xa014c00
y.create.l HWIO_WCSS_A_TDC_TDCSYM_OUT_ADDR A:0xa014c04
y.create.l HWIO_WCSS_A_TDC_TDCPKT_IN_ADDR A:0xa014c08
y.create.l HWIO_WCSS_A_TDC_CWDET_COUNT_ADDR A:0xa014c0c
y.create.l HWIO_WCSS_A_TDC_CWDET_STATUS_ADDR A:0xa014c10
y.create.l HWIO_WCSS_A_TDC_CWDET_OVERRIDE_ADDR A:0xa014c14
y.create.l HWIO_WCSS_A_TDC_CWDET_TRIGGER_ADDR A:0xa014c18
y.create.l HWIO_WCSS_A_TDC_APB_GAIN_THRESH_LLP64_1RX_ADDR A:0xa014c1c
y.create.l HWIO_WCSS_A_TDC_APB_GAIN_THRESH_LLP128_1RX_ADDR A:0xa014c20
y.create.l HWIO_WCSS_A_TDC_APB_GAIN_THRESH_HTLTF64_1RX_ADDR A:0xa014c24
y.create.l HWIO_WCSS_A_TDC_APB_GAIN_THRESH_HTLTF128_1RX_ADDR A:0xa014c28
y.create.l HWIO_WCSS_A_TDC_APB_GAIN_THRESH_LLP256_1RX_ADDR A:0xa014c2c
y.create.l HWIO_WCSS_A_TDC_APB_GAIN_THRESH_VHTLTF256_1RX_ADDR A:0xa014c30
y.create.l HWIO_WCSS_A_TDC_RAM_OVERFLOW_ADDR A:0xa014c34
y.create.l HWIO_WCSS_A_TPC_TXPWR_OVERRIDE_11A0_ADDR A:0xa010000
y.create.l HWIO_WCSS_A_TPC_TXPWR_OVERRIDE_11B0_ADDR A:0xa010004
y.create.l HWIO_WCSS_A_TPC_TXPWR_ENABLE_ADDR A:0xa010008
y.create.l HWIO_WCSS_A_TPC_ADC_CTRL_GET_ADC_ADDR A:0xa01000c
y.create.l HWIO_WCSS_A_TPC_ADC_STATUS_ADDR A:0xa010010
y.create.l HWIO_WCSS_A_TPC_MAN_TXPWR_ADDR A:0xa010014
y.create.l HWIO_WCSS_A_TPC_MAX_RF_GAIN_ADDR A:0xa010018
y.create.l HWIO_WCSS_A_TPC_MIN_RF_GAIN_ADDR A:0xa01001c
y.create.l HWIO_WCSS_A_TPC_MAX_DIGITAL_GAIN_ADDR A:0xa010020
y.create.l HWIO_WCSS_A_TPC_MID_DIGITAL_GAIN_ADDR A:0xa010024
y.create.l HWIO_WCSS_A_TPC_MIN_DIGITAL_GAIN_ADDR A:0xa010028
y.create.l HWIO_WCSS_A_TPC_RC_DELAY_ADDR A:0xa010030
y.create.l HWIO_WCSS_A_TPC_SENSED_PWR0_ADDR A:0xa010034
y.create.l HWIO_WCSS_A_TPC_ADCTIMEOUT_ADDR A:0xa010038
y.create.l HWIO_WCSS_A_TPC_APBACCESS_ADDR A:0xa01003c
y.create.l HWIO_WCSS_A_TPC_PTADC_FSM_RST_ADDR A:0xa010040
y.create.l HWIO_WCSS_A_TPC_PDADC_RANGE_ADDR A:0xa010048
y.create.l HWIO_WCSS_A_TPC_PDADC_OFFSET_ADDR A:0xa01004c
y.create.l HWIO_WCSS_A_TPC_GAIN_OFFSET1_ADDR A:0xa010050
y.create.l HWIO_WCSS_A_TPC_GAIN_OFFSET2_ADDR A:0xa010054
y.create.l HWIO_WCSS_A_TPC_DEMANDED_PWR_RANGE_ADDR A:0xa010058
y.create.l HWIO_WCSS_A_TPC_LAST_DEMANDED_PWR_ADDR A:0xa01005c
y.create.l HWIO_WCSS_A_TPC_POWERDET0_RAM0_ADDR A:0xa010800
y.create.l HWIO_WCSS_A_TPC_POWERDET0_RAM1_ADDR A:0xa010804
y.create.l HWIO_WCSS_A_TPC_POWERDET0_RAM2_ADDR A:0xa010808
y.create.l HWIO_WCSS_A_TPC_POWERDET0_RAM3_ADDR A:0xa01080c
y.create.l HWIO_WCSS_A_TPC_POWERDET0_RAM4_ADDR A:0xa010810
y.create.l HWIO_WCSS_A_TPC_POWERDET0_RAM5_ADDR A:0xa010814
y.create.l HWIO_WCSS_A_TPC_POWERDET0_RAM6_ADDR A:0xa010818
y.create.l HWIO_WCSS_A_TPC_POWERDET0_RAM7_ADDR A:0xa01081c
y.create.l HWIO_WCSS_A_TPC_POWERDET0_RAM8_ADDR A:0xa010820
y.create.l HWIO_WCSS_A_TPC_POWERDET0_RAM9_ADDR A:0xa010824
y.create.l HWIO_WCSS_A_TPC_RF_GAIN_LUT00_ADDR A:0xa010c00
y.create.l HWIO_WCSS_A_TPC_RF_GAIN_LUT01_ADDR A:0xa010c04
y.create.l HWIO_WCSS_A_TPC_RF_GAIN_LUT02_ADDR A:0xa010c08
y.create.l HWIO_WCSS_A_TPC_RF_GAIN_LUT03_ADDR A:0xa010c0c
y.create.l HWIO_WCSS_A_TPC_RF_GAIN_LUT04_ADDR A:0xa010c10
y.create.l HWIO_WCSS_A_TPC_RF_GAIN_LUT05_ADDR A:0xa010c14
y.create.l HWIO_WCSS_A_TPC_RF_GAIN_LUT06_ADDR A:0xa010c18
y.create.l HWIO_WCSS_A_TPC_RF_GAIN_LUT07_ADDR A:0xa010c1c
y.create.l HWIO_WCSS_A_TPC_RF_GAIN_LUT08_ADDR A:0xa010c20
y.create.l HWIO_WCSS_A_TPC_RF_GAIN_LUT09_ADDR A:0xa010c24
y.create.l HWIO_WCSS_A_TPC_DIGITAL_GAIN_LUT00_ADDR A:0xa010c80
y.create.l HWIO_WCSS_A_TPC_DIGITAL_GAIN_LUT01_ADDR A:0xa010c84
y.create.l HWIO_WCSS_A_TPC_DIGITAL_GAIN_LUT02_ADDR A:0xa010c88
y.create.l HWIO_WCSS_A_TPC_DIGITAL_GAIN_LUT03_ADDR A:0xa010c8c
y.create.l HWIO_WCSS_A_TPC_DIGITAL_GAIN_LUT04_ADDR A:0xa010c90
y.create.l HWIO_WCSS_A_TPC_DIGITAL_GAIN_LUT05_ADDR A:0xa010c94
y.create.l HWIO_WCSS_A_TPC_DIGITAL_GAIN_LUT06_ADDR A:0xa010c98
y.create.l HWIO_WCSS_A_TPC_DIGITAL_GAIN_LUT07_ADDR A:0xa010c9c
y.create.l HWIO_WCSS_A_TPC_DIGITAL_GAIN_LUT08_ADDR A:0xa010ca0
y.create.l HWIO_WCSS_A_TPC_DIGITAL_GAIN_LUT09_ADDR A:0xa010ca4
y.create.l HWIO_WCSS_A_TPE_EDCF_TXOP_0_1_ADDR A:0xa082000
y.create.l HWIO_WCSS_A_TPE_EDCF_TXOP_2_3_ADDR A:0xa082004
y.create.l HWIO_WCSS_A_TPE_EDCF_TXOP_4_5_ADDR A:0xa082008
y.create.l HWIO_WCSS_A_TPE_EDCF_TXOP_6_7_ADDR A:0xa08200c
y.create.l HWIO_WCSS_A_TPE_SW_TEMPLATE_BASE_ADDR_ADDR A:0xa082010
y.create.l HWIO_WCSS_A_TPE_SW_TPE_HW_CONTROL_REG_ADDR A:0xa082014
y.create.l HWIO_WCSS_A_TPE_SW_SOFTWARE_TX_CONTROL_REG1_ADDR A:0xa082018
y.create.l HWIO_WCSS_A_TPE_SW_SOFTWARE_TX_ADDRESS_ADDR A:0xa08201c
y.create.l HWIO_WCSS_A_TPE_SW_MAX_BYTES_AND_TX_TIME_IN_AMPDU_ADDR A:0xa082020
y.create.l HWIO_WCSS_A_TPE_SW_MAX_MPDUS_IN_AMPDU_AND_MISC_ADDR A:0xa082024
y.create.l HWIO_WCSS_A_TPE_SW_STA_DESCR_ADDR_ADDR A:0xa082028
y.create.l HWIO_WCSS_A_TPE_SW_TPE_TEST_AND_MISC_ADDR A:0xa082030
y.create.l HWIO_WCSS_A_TPE_SW_PM_ADDR A:0xa082034
y.create.l HWIO_WCSS_A_TPE_SW_TPE_TEST_BUS_LOWER_ADDR A:0xa082038
y.create.l HWIO_WCSS_A_TPE_SW_11G_CTRL_INDEX_OFFSET_ADDR A:0xa08203c
y.create.l HWIO_WCSS_A_TPE_RATE_TABLE_SRAM_CONTROL_ADDR A:0xa082040
y.create.l HWIO_WCSS_A_TPE_RATE_TABLE_SRAM_CONTROL2_ADDR A:0xa082044
y.create.l HWIO_WCSS_A_TPE_SW_BEACON_BASE_ADDR_ADDR A:0xa082050
y.create.l HWIO_WCSS_A_TPE_SW_BEACON_MAX_SIZE_MISC_ADDR A:0xa082054
y.create.l HWIO_WCSS_A_TPE_SW_GLOBAL_CF_END_DATA_POWER_TEMPLATE_ADDR A:0xa082058
y.create.l HWIO_WCSS_A_TPE_TPE_BMU_INTERFACE_CNTS_ADDR A:0xa082080
y.create.l HWIO_WCSS_A_TPE_RXP_TPE_INTERFACE_CNTS_ADDR A:0xa082084
y.create.l HWIO_WCSS_A_TPE_MTU_TPE_INTERFACE_CNTS_ADDR A:0xa082088
y.create.l HWIO_WCSS_A_TPE_RPE_TPE_INTERFACE_CNTS_ADDR A:0xa08208c
y.create.l HWIO_WCSS_A_TPE_ERROR_INT_CNTS_ADDR A:0xa082090
y.create.l HWIO_WCSS_A_TPE_UNICAST_BYTES_LOWER_ADDR A:0xa0820c0
y.create.l HWIO_WCSS_A_TPE_UNICAST_BYTES_UPPER_ADDR A:0xa0820c4
y.create.l HWIO_WCSS_A_TPE_MULTICAST_BYTES_LOWER_ADDR A:0xa0820c8
y.create.l HWIO_WCSS_A_TPE_MULTICAST_BYTES_UPPER_ADDR A:0xa0820cc
y.create.l HWIO_WCSS_A_TPE_BROADCAST_BYTES_LOWER_ADDR A:0xa0820d0
y.create.l HWIO_WCSS_A_TPE_BROADCAST_BYTES_UPPER_ADDR A:0xa0820d4
y.create.l HWIO_WCSS_A_TPE_STATISTIC_COUNTERS_CNTL_ADDR A:0xa082100
y.create.l HWIO_WCSS_A_TPE_TPE_STATUS_REG_LOWER_ADDR A:0xa082104
y.create.l HWIO_WCSS_A_TPE_TPE_STATUS_REG_UPPER_ADDR A:0xa082108
y.create.l HWIO_WCSS_A_TPE_GOT_ACK_FOR_BACK_INFO_REG_ADDR A:0xa082110
y.create.l HWIO_WCSS_A_TPE_SW_DELAY_WAIT_CMD_CNT_REG_ADDR A:0xa082118
y.create.l HWIO_WCSS_A_TPE_SW_MEDIUM_TIME_USED_AC0_ADDR A:0xa08211c
y.create.l HWIO_WCSS_A_TPE_SW_MEDIUM_TIME_USED_AC1_ADDR A:0xa082120
y.create.l HWIO_WCSS_A_TPE_SW_MEDIUM_TIME_USED_AC2_ADDR A:0xa082124
y.create.l HWIO_WCSS_A_TPE_SW_MEDIUM_TIME_USED_AC3_ADDR A:0xa082128
y.create.l HWIO_WCSS_A_TPE_SW_MEDIUM_TIME_THR_AC0_AC1_ADDR A:0xa08212c
y.create.l HWIO_WCSS_A_TPE_SW_MEDIUM_TIME_THR_AC2_AC3_ADDR A:0xa082130
y.create.l HWIO_WCSS_A_TPE_SW_ADMISSION_CONTROL_CONTROL_REG_ADDR A:0xa082134
y.create.l HWIO_WCSS_A_TPE_SW_LIFE_TIME_DROP_CNT_ADDR A:0xa08213c
y.create.l HWIO_WCSS_A_TPE_TPE_MCU_BD_BASED_TX_INT_FEEDBACK_ADDR A:0xa082140
y.create.l HWIO_WCSS_A_TPE_TPE_MCU_BD_BASED_TX_INT_FEEDBACK_1_ADDR A:0xa082144
y.create.l HWIO_WCSS_A_TPE_WRONG_BA_SSN_TID_FEEDBACK_ADDR A:0xa082148
y.create.l HWIO_WCSS_A_TPE_SW_CAPPED_POWER_CONTROL_ADDR A:0xa08214c
y.create.l HWIO_WCSS_A_TPE_SW_ACK_TO_DUE_TO_BTC_COUNT_ADDR A:0xa082150
y.create.l HWIO_WCSS_A_TPE_SW_LOW_PRIORITY_BT_REJECTED_COUNT_ADDR A:0xa082154
y.create.l HWIO_WCSS_A_TPE_SW_TERMINATE_CURRENT_TX_VALID_ADDR A:0xa082158
y.create.l HWIO_WCSS_A_TPE_RTT_REGISTER_ADDR A:0xa08215c
y.create.l HWIO_WCSS_A_TPE_BEAMFORM_CTRL_ADDR A:0xa082160
y.create.l HWIO_WCSS_A_TPE_CFG_CSI_ADDR_ADDR A:0xa082164
y.create.l HWIO_WCSS_A_TPE_INTERRUPT_ENABLE_ADDR A:0xa082168
y.create.l HWIO_WCSS_A_TPE_INTERRUPT_STATUS_ADDR A:0xa08216c
y.create.l HWIO_WCSS_A_TPE_BEAMFORM_STATUS_ADDR A:0xa082170
y.create.l HWIO_WCSS_A_TPE_CALIBRATION_CNT_ADDR A:0xa082174
y.create.l HWIO_WCSS_A_TPE_BEAMFORM_CNT_ADDR A:0xa082178
y.create.l HWIO_WCSS_A_TPE_SW_PM_2_ADDR A:0xa08217c
y.create.l HWIO_WCSS_A_TPE_SW_11AC_PADDING_ADDR A:0xa082198
y.create.l HWIO_WCSS_A_TPE_NDP_BEAMFORM_CTRL_ADDR A:0xa0821b0
y.create.l HWIO_WCSS_A_TPE_BEAMFORM_QOSNULL_NDP_CNT_ADDR A:0xa0821b4
y.create.l HWIO_WCSS_A_TPE_CXM_CTRL_ADDR A:0xa0821b8
y.create.l HWIO_WCSS_A_TPE_SW_11AC_CTRL_ADDR A:0xa0821bc
y.create.l HWIO_WCSS_A_TPE_SW_NONHT_BW_CTRL_ADDR A:0xa0821e4
y.create.l HWIO_WCSS_A_TPE_SW_GLOBAL_CF_END_DATA_POWER_TEMPLATE_40MHZ_ADDR A:0xa0821e8
y.create.l HWIO_WCSS_A_TPE_SW_GLOBAL_CF_END_DATA_POWER_TEMPLATE_80MHZ_ADDR A:0xa0821ec
y.create.l HWIO_WCSS_A_TPE_SW_WARMUP_DELAY_ADDR A:0xa0821f0
y.create.l HWIO_WCSS_A_TPE_MAIN_MPROC_REQ_CNT_ADDR A:0xa0821f4
y.create.l HWIO_WCSS_A_TPE_SW_11AC_BEAMFORM_CTRL_ADDR A:0xa0821f8
y.create.l HWIO_WCSS_A_TPE_SW_11AC_CNT1_ADDR A:0xa0821fc
y.create.l HWIO_WCSS_A_TPE_SW_11AC_CNT2_ADDR A:0xa0821ac
y.create.l HWIO_WCSS_A_TPE_SW_11AC_VHTCB_RATE_ADDR A:0xa0821a8
y.create.l HWIO_WCSS_A_TPE_SW_VHTCB_ADDR2_0_LO_ADDR A:0xa0821a0
y.create.l HWIO_WCSS_A_TPE_SW_VHTCB_ADDR2_0_HI_ADDR A:0xa0821a4
y.create.l HWIO_WCSS_A_TPE_SW_VHTCB_ADDR2_1_LO_ADDR A:0xa0821c0
y.create.l HWIO_WCSS_A_TPE_SW_VHTCB_ADDR2_1_HI_ADDR A:0xa0821c4
y.create.l HWIO_WCSS_A_TPE_SW_VHTCB_ADDR2_LOOKUP_ADDR A:0xa0821c8
y.create.l HWIO_WCSS_A_TPE_SW_RTT3_ABSOLUTE_ADDR A:0xa0821cc
y.create.l HWIO_WCSS_A_TPE_SW_RTT3_DELTA_ADDR A:0xa0821d0
y.create.l HWIO_WCSS_A_TPE_SW_RTT3_CTRL_ADDR A:0xa0821d4
y.create.l HWIO_WCSS_A_TPE_SW_RTT3_CTRL2_ADDR A:0xa0821d8
y.create.l HWIO_WCSS_A_TPE_SW_11AF_CTRL_ADDR A:0xa0821dc
y.create.l HWIO_WCSS_A_TPE_SW_QBOOST_CTRL_ADDR A:0xa0821e0
y.create.l HWIO_WCSS_A_TXCLKCTRL_ROOT_CLK_EN_ADDR A:0xa013000
y.create.l HWIO_WCSS_A_TXCLKCTRL_APB_BLOCK_CLK_EN_ADDR A:0xa013004
y.create.l HWIO_WCSS_A_TXCLKCTRL_APB_BLOCK_DYN_CLKG_DISABLE_ADDR A:0xa013008
y.create.l HWIO_WCSS_A_TXCTL_FIR_MODE_ADDR A:0xa012000
y.create.l HWIO_WCSS_A_TXCTL_PA_GUARD_ADDR A:0xa012004
y.create.l HWIO_WCSS_A_TXCTL_RAMP_UP_11A_ADDR A:0xa012008
y.create.l HWIO_WCSS_A_TXCTL_RAMP_UP_11B_ADDR A:0xa01200c
y.create.l HWIO_WCSS_A_TXCTL_RAMP_DOWN_ADDR A:0xa012010
y.create.l HWIO_WCSS_A_TXCTL_TESTMUX_SELECT_ADDR A:0xa012014
y.create.l HWIO_WCSS_A_TXCTL_DAC_CONTROL_ADDR A:0xa012018
y.create.l HWIO_WCSS_A_TXCTL_DAC_STDBY_ADDR A:0xa01201c
y.create.l HWIO_WCSS_A_TXCTL_PLCP_OVERRIDE_ADDR A:0xa012020
y.create.l HWIO_WCSS_A_TXCTL_FSHIFT_ADDR A:0xa012024
y.create.l HWIO_WCSS_A_TXCTL_SOFTRESET_ADDR A:0xa012028
y.create.l HWIO_WCSS_A_TXCTL_WATCHDOG_START_ADDR A:0xa01202c
y.create.l HWIO_WCSS_A_TXCTL_WATCHDOG_RFWARM_ADDR A:0xa012030
y.create.l HWIO_WCSS_A_TXCTL_WATCHDOG_PAGUARD_ADDR A:0xa012034
y.create.l HWIO_WCSS_A_TXCTL_WATCHDOG_RAMPUP_ADDR A:0xa012038
y.create.l HWIO_WCSS_A_TXCTL_WATCHDOG_TX_ADDR A:0xa01203c
y.create.l HWIO_WCSS_A_TXCTL_WATCHDOG_SHUTOFF_ADDR A:0xa012040
y.create.l HWIO_WCSS_A_TXCTL_WATCHDOG_TPC_ADDR A:0xa012044
y.create.l HWIO_WCSS_A_TXCTL_MAX_TXBUSY_ADDR A:0xa012048
y.create.l HWIO_WCSS_A_TXCTL_MAX_TXENB_ADDR A:0xa01204c
y.create.l HWIO_WCSS_A_TXCTL_TXBUSY_ALARM_ADDR A:0xa012050
y.create.l HWIO_WCSS_A_TXCTL_TXEN_ALARM_ADDR A:0xa012054
y.create.l HWIO_WCSS_A_TXCTL_TXCTL_STATE_ADDR A:0xa012058
y.create.l HWIO_WCSS_A_TXCTL_LAST_PKT_PARAMS1_ADDR A:0xa01205c
y.create.l HWIO_WCSS_A_TXCTL_LAST_PKT_PACKET_LENGTH_ADDR A:0xa012060
y.create.l HWIO_WCSS_A_TXCTL_LAST_PKT_LSIG_LENGTH_ADDR A:0xa012064
y.create.l HWIO_WCSS_A_TXCTL_LAST_TX_POWER_ADDR A:0xa012068
y.create.l HWIO_WCSS_A_TXCTL_WATCHDOG_ALARM_ADDR A:0xa01206c
y.create.l HWIO_WCSS_A_TXCTL_PKT_INVALID_ALARM_ADDR A:0xa012070
y.create.l HWIO_WCSS_A_TXCTL_TXA_ABORT_ALARM_ADDR A:0xa012074
y.create.l HWIO_WCSS_A_TXCTL_LEGACY_PKTS_ADDR A:0xa012078
y.create.l HWIO_WCSS_A_TXCTL_GF_SIMO_20_PKTS_ADDR A:0xa01207c
y.create.l HWIO_WCSS_A_TXCTL_GF_SIMO_40_PKTS_ADDR A:0xa012080
y.create.l HWIO_WCSS_A_TXCTL_MM_SIMO_20_PKTS_ADDR A:0xa012084
y.create.l HWIO_WCSS_A_TXCTL_MM_SIMO_40_PKTS_ADDR A:0xa012088
y.create.l HWIO_WCSS_A_TXCTL_AC_SIMO_20_PKTS_ADDR A:0xa01208c
y.create.l HWIO_WCSS_A_TXCTL_AC_SIMO_40_PKTS_ADDR A:0xa012090
y.create.l HWIO_WCSS_A_TXCTL_AC_SIMO_80_PKTS_ADDR A:0xa012094
y.create.l HWIO_WCSS_A_TXCTL_TXB_SHORT_PKTS_ADDR A:0xa012098
y.create.l HWIO_WCSS_A_TXCTL_TXB_LONG_PKTS_ADDR A:0xa01209c
y.create.l HWIO_WCSS_A_TXCTL_TXFIR_DONE_ADDR A:0xa0120a0
y.create.l HWIO_WCSS_A_TXCTL_MISSING_WARMUP_ADDR A:0xa0120a4
y.create.l HWIO_WCSS_A_TXCTL_ALARMS_ADDR A:0xa0120a8
y.create.l HWIO_WCSS_A_TXCTL_RESET_ALARMS_ADDR A:0xa0120ac
y.create.l HWIO_WCSS_A_TXFIR_CFG_ADDR A:0xa018000
y.create.l HWIO_WCSS_A_TXFIR_LOLEAKAGE_SHIFT_ADDR A:0xa018004
y.create.l HWIO_WCSS_A_TXFIR_COEFF_QUARTER_0_ADDR A:0xa01800c
y.create.l HWIO_WCSS_A_TXFIR_COEFF_QUARTER_1_ADDR A:0xa018010
y.create.l HWIO_WCSS_A_TXFIR_COEFF_QUARTER_2_ADDR A:0xa018014
y.create.l HWIO_WCSS_A_TXFIR_COEFF_QUARTER_3_ADDR A:0xa018018
y.create.l HWIO_WCSS_A_TXFIR_COEFF_QUARTER_4_ADDR A:0xa01801c
y.create.l HWIO_WCSS_A_TXFIR_COEFF_QUARTER_5_ADDR A:0xa018020
y.create.l HWIO_WCSS_A_TXFIR_COEFF_QUARTER_6_ADDR A:0xa018024
y.create.l HWIO_WCSS_A_TXFIR_COEFF_QUARTER_7_ADDR A:0xa018028
y.create.l HWIO_WCSS_A_TXFIR_COEFF_QUARTER_8_ADDR A:0xa01802c
y.create.l HWIO_WCSS_A_TXFIR_COEFF_QUARTER_9_ADDR A:0xa018030
y.create.l HWIO_WCSS_A_TXFIR_COEFF_QUARTER_10_ADDR A:0xa018034
y.create.l HWIO_WCSS_A_TXFIR_COEFF_QUARTER_11_ADDR A:0xa018038
y.create.l HWIO_WCSS_A_TXFIR_COEFF_QUARTER_12_ADDR A:0xa01803c
y.create.l HWIO_WCSS_A_TXFIR_COEFF_QUARTER_13_ADDR A:0xa018040
y.create.l HWIO_WCSS_A_TXFIR_COEFF_QUARTER_14_ADDR A:0xa018044
y.create.l HWIO_WCSS_A_TXFIR_COEFF_QUARTER_15_ADDR A:0xa018048
y.create.l HWIO_WCSS_A_TXFIR_COEFF_QUARTER_16_ADDR A:0xa01804c
y.create.l HWIO_WCSS_A_TXFIR_COEFF_QUARTER_17_ADDR A:0xa018050
y.create.l HWIO_WCSS_A_TXFIR_COEFF_QUARTER_18_ADDR A:0xa018054
y.create.l HWIO_WCSS_A_TXFIR_COEFF_QUARTER_19_ADDR A:0xa018058
y.create.l HWIO_WCSS_A_TXFIR_COEFF_QUARTER_20_ADDR A:0xa01805c
y.create.l HWIO_WCSS_A_TXFIR_COEFF_QUARTER_21_ADDR A:0xa018060
y.create.l HWIO_WCSS_A_TXFIR_COEFF_QUARTER_22_ADDR A:0xa018064
y.create.l HWIO_WCSS_A_TXFIR_COEFF_QUARTER_23_ADDR A:0xa018068
y.create.l HWIO_WCSS_A_TXFIR_COEFF_QUARTER_24_ADDR A:0xa01806c
y.create.l HWIO_WCSS_A_TXFIR_COEFF_QUARTER_25_ADDR A:0xa018070
y.create.l HWIO_WCSS_A_TXFIR_COEFF_QUARTER_26_ADDR A:0xa018074
y.create.l HWIO_WCSS_A_TXFIR_COEFF_QUARTER_27_ADDR A:0xa018078
y.create.l HWIO_WCSS_A_TXFIR_COEFF_QUARTER_28_ADDR A:0xa01807c
y.create.l HWIO_WCSS_A_TXFIR_COEFF_QUARTER_29_ADDR A:0xa018080
y.create.l HWIO_WCSS_A_TXFIR_COEFF_QUARTER_30_ADDR A:0xa018084
y.create.l HWIO_WCSS_A_TXFIR_COEFF_QUARTER_31_ADDR A:0xa018088
y.create.l HWIO_WCSS_A_TXFIR_COEFF_QUARTER_32_ADDR A:0xa01808c
y.create.l HWIO_WCSS_A_TXFIR_COEFF_QUARTER_33_ADDR A:0xa018090
y.create.l HWIO_WCSS_A_TXFIR_COEFF_QUARTER_34_ADDR A:0xa018094
y.create.l HWIO_WCSS_A_TXFIR_COEFF_QUARTER_35_ADDR A:0xa018098
y.create.l HWIO_WCSS_A_TXFIR_COEFF_QUARTER_36_ADDR A:0xa01809c
y.create.l HWIO_WCSS_A_TXFIR_COEFF_QUARTER_37_ADDR A:0xa0180a0
y.create.l HWIO_WCSS_A_TXFIR_COEFF_QUARTER_38_ADDR A:0xa0180a4
y.create.l HWIO_WCSS_A_TXFIR_COEFF_QUARTER_39_ADDR A:0xa0180a8
y.create.l HWIO_WCSS_A_TXFIR_COEFF_QUARTER_40_ADDR A:0xa0180ac
y.create.l HWIO_WCSS_A_TXFIR_COEFF_QUARTER_41_ADDR A:0xa0180b0
y.create.l HWIO_WCSS_A_TXFIR_COEFF_HALF_0_ADDR A:0xa0180b4
y.create.l HWIO_WCSS_A_TXFIR_COEFF_HALF_1_ADDR A:0xa0180b8
y.create.l HWIO_WCSS_A_TXFIR_COEFF_HALF_2_ADDR A:0xa0180bc
y.create.l HWIO_WCSS_A_TXFIR_COEFF_HALF_3_ADDR A:0xa0180c0
y.create.l HWIO_WCSS_A_TXFIR_COEFF_HALF_4_ADDR A:0xa0180c4
y.create.l HWIO_WCSS_A_TXFIR_COEFF_HALF_5_ADDR A:0xa0180c8
y.create.l HWIO_WCSS_A_TXFIR_COEFF_HALF_6_ADDR A:0xa0180cc
y.create.l HWIO_WCSS_A_TXFIR_COEFF_HALF_7_ADDR A:0xa0180d0
y.create.l HWIO_WCSS_A_TXFIR_COEFF_HALF_8_ADDR A:0xa0180d4
y.create.l HWIO_WCSS_A_TXFIR_COEFF_HALF_9_ADDR A:0xa0180d8
y.create.l HWIO_WCSS_A_TXFIR_COEFF_HALF_10_ADDR A:0xa0180dc
y.create.l HWIO_WCSS_A_TXFIR_COEFF_HALF_11_ADDR A:0xa0180e0
y.create.l HWIO_WCSS_A_TXFIR_COEFF_HALF_12_ADDR A:0xa0180e4
y.create.l HWIO_WCSS_A_TXFIR_COEFF_HALF_13_ADDR A:0xa0180e8
y.create.l HWIO_WCSS_A_TXFIR_COEFF_HALF_14_ADDR A:0xa0180ec
y.create.l HWIO_WCSS_A_TXFIR_COEFF_HALF_15_ADDR A:0xa0180f0
y.create.l HWIO_WCSS_A_TXFIR_COEFF_HALF_16_ADDR A:0xa0180f4
y.create.l HWIO_WCSS_A_TXFIR_COEFF_HALF_17_ADDR A:0xa0180f8
y.create.l HWIO_WCSS_A_TXFIR_COEFF_HALF_18_ADDR A:0xa0180fc
y.create.l HWIO_WCSS_A_TXFIR_COEFF_HALF_19_ADDR A:0xa018100
y.create.l HWIO_WCSS_A_TXFIR_COEFF_HALF_20_ADDR A:0xa018104
y.create.l HWIO_WCSS_A_TXFIR_COEFF_HALF_21_ADDR A:0xa018108
y.create.l HWIO_WCSS_A_TXFIR_COEFF_HALF_22_ADDR A:0xa01810c
y.create.l HWIO_WCSS_A_TXFIR_COEFF_HALF_23_ADDR A:0xa018110
y.create.l HWIO_WCSS_A_TXFIR_COEFF_HALF_24_ADDR A:0xa018114
y.create.l HWIO_WCSS_A_TXFIR_COEFF_HALF_25_ADDR A:0xa018118
y.create.l HWIO_WCSS_A_TXFIR_COEFF_HALF_26_ADDR A:0xa01811c
y.create.l HWIO_WCSS_A_TXFIR_COEFF_HALF_27_ADDR A:0xa018120
y.create.l HWIO_WCSS_A_TXFIR_COEFF_HALF_28_ADDR A:0xa018124
y.create.l HWIO_WCSS_A_TXFIR_COEFF_HALF_29_ADDR A:0xa018128
y.create.l HWIO_WCSS_A_TXFIR_COEFF_HALF_30_ADDR A:0xa01812c
y.create.l HWIO_WCSS_A_TXFIR_COEFF_HALF_31_ADDR A:0xa018130
y.create.l HWIO_WCSS_A_TXFIR_COEFF_HALF_32_ADDR A:0xa018134
y.create.l HWIO_WCSS_A_TXFIR_COEFF_HALF_33_ADDR A:0xa018138
y.create.l HWIO_WCSS_A_TXFIR_COEFF_HALF_34_ADDR A:0xa01813c
y.create.l HWIO_WCSS_A_TXFIR_COEFF_HALF_35_ADDR A:0xa018140
y.create.l HWIO_WCSS_A_TXFIR_COEFF_HALF_36_ADDR A:0xa018144
y.create.l HWIO_WCSS_A_TXFIR_COEFF_HALF_37_ADDR A:0xa018148
y.create.l HWIO_WCSS_A_TXFIR_COEFF_HALF_38_ADDR A:0xa01814c
y.create.l HWIO_WCSS_A_TXFIR_COEFF_HALF_39_ADDR A:0xa018150
y.create.l HWIO_WCSS_A_TXFIR_COEFF_HALF_40_ADDR A:0xa018154
y.create.l HWIO_WCSS_A_TXFIR_COEFF_HALF_41_ADDR A:0xa018158
y.create.l HWIO_WCSS_A_TXFIR_COEFF_FULL_0_ADDR A:0xa01815c
y.create.l HWIO_WCSS_A_TXFIR_COEFF_FULL_1_ADDR A:0xa018160
y.create.l HWIO_WCSS_A_TXFIR_COEFF_FULL_2_ADDR A:0xa018164
y.create.l HWIO_WCSS_A_TXFIR_COEFF_FULL_3_ADDR A:0xa018168
y.create.l HWIO_WCSS_A_TXFIR_COEFF_FULL_4_ADDR A:0xa01816c
y.create.l HWIO_WCSS_A_TXFIR_COEFF_FULL_5_ADDR A:0xa018170
y.create.l HWIO_WCSS_A_TXFIR_COEFF_FULL_6_ADDR A:0xa018174
y.create.l HWIO_WCSS_A_TXFIR_COEFF_FULL_7_ADDR A:0xa018178
y.create.l HWIO_WCSS_A_TXFIR_COEFF_FULL_8_ADDR A:0xa01817c
y.create.l HWIO_WCSS_A_TXFIR_COEFF_FULL_9_ADDR A:0xa018180
y.create.l HWIO_WCSS_A_TXFIR_COEFF_FULL_10_ADDR A:0xa018184
y.create.l HWIO_WCSS_A_TXFIR_COEFF_FULL_11_ADDR A:0xa018188
y.create.l HWIO_WCSS_A_TXFIR_COEFF_FULL_12_ADDR A:0xa01818c
y.create.l HWIO_WCSS_A_TXFIR_COEFF_FULL_13_ADDR A:0xa018190
y.create.l HWIO_WCSS_A_TXFIR_COEFF_FULL_14_ADDR A:0xa018194
y.create.l HWIO_WCSS_A_TXFIR_COEFF_FULL_15_ADDR A:0xa018198
y.create.l HWIO_WCSS_A_TXFIR_COEFF_FULL_16_ADDR A:0xa01819c
y.create.l HWIO_WCSS_A_TXFIR_COEFF_FULL_17_ADDR A:0xa0181a0
y.create.l HWIO_WCSS_A_TXFIR_COEFF_FULL_18_ADDR A:0xa0181a4
y.create.l HWIO_WCSS_A_TXFIR_COEFF_FULL_19_ADDR A:0xa0181a8
y.create.l HWIO_WCSS_A_TXFIR_COEFF_FULL_20_ADDR A:0xa0181ac
y.create.l HWIO_WCSS_A_TXFIR_COEFF_FULL_21_ADDR A:0xa0181b0
y.create.l HWIO_WCSS_A_TXFIR_COEFF_FULL_22_ADDR A:0xa0181b4
y.create.l HWIO_WCSS_A_TXFIR_COEFF_FULL_23_ADDR A:0xa0181b8
y.create.l HWIO_WCSS_A_TXFIR_COEFF_FULL_24_ADDR A:0xa0181bc
y.create.l HWIO_WCSS_A_TXFIR_COEFF_FULL_25_ADDR A:0xa0181c0
y.create.l HWIO_WCSS_A_TXFIR_COEFF_FULL_26_ADDR A:0xa0181c4
y.create.l HWIO_WCSS_A_TXFIR_COEFF_FULL_27_ADDR A:0xa0181c8
y.create.l HWIO_WCSS_A_TXFIR_COEFF_FULL_28_ADDR A:0xa0181cc
y.create.l HWIO_WCSS_A_TXFIR_COEFF_FULL_29_ADDR A:0xa0181d0
y.create.l HWIO_WCSS_A_TXFIR_COEFF_FULL_30_ADDR A:0xa0181d4
y.create.l HWIO_WCSS_A_TXFIR_COEFF_FULL_31_ADDR A:0xa0181d8
y.create.l HWIO_WCSS_A_TXFIR_COEFF_FULL_32_ADDR A:0xa0181dc
y.create.l HWIO_WCSS_A_TXFIR_COEFF_FULL_33_ADDR A:0xa0181e0
y.create.l HWIO_WCSS_A_TXFIR_COEFF_FULL_34_ADDR A:0xa0181e4
y.create.l HWIO_WCSS_A_TXFIR_COEFF_FULL_35_ADDR A:0xa0181e8
y.create.l HWIO_WCSS_A_TXFIR_COEFF_FULL_36_ADDR A:0xa0181ec
y.create.l HWIO_WCSS_A_TXFIR_COEFF_FULL_37_ADDR A:0xa0181f0
y.create.l HWIO_WCSS_A_TXFIR_COEFF_FULL_38_ADDR A:0xa0181f4
y.create.l HWIO_WCSS_A_TXFIR_COEFF_FULL_39_ADDR A:0xa0181f8
y.create.l HWIO_WCSS_A_TXFIR_COEFF_FULL_40_ADDR A:0xa0181fc
y.create.l HWIO_WCSS_A_TXFIR_COEFF_FULL_41_ADDR A:0xa018200
y.create.l HWIO_WCSS_A_TXFIR_COEFF_TXB_20_0_ADDR A:0xa018204
y.create.l HWIO_WCSS_A_TXFIR_COEFF_TXB_20_1_ADDR A:0xa018208
y.create.l HWIO_WCSS_A_TXFIR_COEFF_TXB_20_2_ADDR A:0xa01820c
y.create.l HWIO_WCSS_A_TXFIR_COEFF_TXB_20_3_ADDR A:0xa018210
y.create.l HWIO_WCSS_A_TXFIR_COEFF_TXB_20_4_ADDR A:0xa018214
y.create.l HWIO_WCSS_A_TXFIR_COEFF_TXB_20_5_ADDR A:0xa018218
y.create.l HWIO_WCSS_A_TXFIR_COEFF_TXB_20_6_ADDR A:0xa01821c
y.create.l HWIO_WCSS_A_TXFIR_COEFF_TXB_20_7_ADDR A:0xa018220
y.create.l HWIO_WCSS_A_TXFIR_COEFF_TXB_20_8_ADDR A:0xa018224
y.create.l HWIO_WCSS_A_TXFIR_COEFF_TXB_20_9_ADDR A:0xa018228
y.create.l HWIO_WCSS_A_TXFIR_COEFF_TXB_20_10_ADDR A:0xa01822c
y.create.l HWIO_WCSS_A_TXFIR_COEFF_TXB_20_11_ADDR A:0xa018230
y.create.l HWIO_WCSS_A_TXFIR_COEFF_TXB_20_12_ADDR A:0xa018234
y.create.l HWIO_WCSS_A_TXFIR_COEFF_TXB_20_13_ADDR A:0xa018238
y.create.l HWIO_WCSS_A_TXFIR_COEFF_TXB_20_14_ADDR A:0xa01823c
y.create.l HWIO_WCSS_A_TXFIR_COEFF_TXB_20_15_ADDR A:0xa018240
y.create.l HWIO_WCSS_A_TXFIR_COEFF_TXB_40_0_ADDR A:0xa018244
y.create.l HWIO_WCSS_A_TXFIR_COEFF_TXB_40_1_ADDR A:0xa018248
y.create.l HWIO_WCSS_A_TXFIR_COEFF_TXB_40_2_ADDR A:0xa01824c
y.create.l HWIO_WCSS_A_TXFIR_COEFF_TXB_40_3_ADDR A:0xa018250
y.create.l HWIO_WCSS_A_TXFIR_COEFF_TXB_40_4_ADDR A:0xa018254
y.create.l HWIO_WCSS_A_TXFIR_COEFF_TXB_40_5_ADDR A:0xa018258
y.create.l HWIO_WCSS_A_TXFIR_COEFF_TXB_40_6_ADDR A:0xa01825c
y.create.l HWIO_WCSS_A_TXFIR_COEFF_TXB_40_7_ADDR A:0xa018260
y.create.l HWIO_WCSS_A_TXFIR_COEFF_TXB_40_8_ADDR A:0xa018264
y.create.l HWIO_WCSS_A_TXFIR_COEFF_TXB_40_9_ADDR A:0xa018268
y.create.l HWIO_WCSS_A_TXFIR_COEFF_TXB_40_10_ADDR A:0xa01826c
y.create.l HWIO_WCSS_A_TXFIR_COEFF_TXB_40_11_ADDR A:0xa018270
y.create.l HWIO_WCSS_A_TXFIR_COEFF_TXB_40_12_ADDR A:0xa018274
y.create.l HWIO_WCSS_A_TXFIR_COEFF_TXB_40_13_ADDR A:0xa018278
y.create.l HWIO_WCSS_A_TXFIR_COEFF_TXB_40_14_ADDR A:0xa01827c
y.create.l HWIO_WCSS_A_TXFIR_COEFF_TXB_40_15_ADDR A:0xa018280
y.create.l HWIO_WCSS_A_TXFIR_COEFF_TXB_40_16_ADDR A:0xa018284
y.create.l HWIO_WCSS_A_TXFIR_COEFF_TXB_40_17_ADDR A:0xa018288
y.create.l HWIO_WCSS_A_TXFIR_COEFF_TXB_40_18_ADDR A:0xa01828c
y.create.l HWIO_WCSS_A_TXFIR_COEFF_TXB_40_19_ADDR A:0xa018290
y.create.l HWIO_WCSS_A_TXFIR_COEFF_TXB_40_20_ADDR A:0xa018294
y.create.l HWIO_WCSS_A_TXFIR_COEFF_TXB_40_21_ADDR A:0xa018298
y.create.l HWIO_WCSS_A_TXFIR_COEFF_TXB_40_22_ADDR A:0xa01829c
y.create.l HWIO_WCSS_A_TXFIR_COEFF_TXB_40_23_ADDR A:0xa0182a0
y.create.l HWIO_WCSS_A_TXFIR_COEFF_TXB_40_24_ADDR A:0xa0182a4
y.create.l HWIO_WCSS_A_TXFIR_COEFF_TXB_40_25_ADDR A:0xa0182a8
y.create.l HWIO_WCSS_A_TXFIR_COEFF_TXB_40_26_ADDR A:0xa0182ac
y.create.l HWIO_WCSS_A_TXFIR_COEFF_TXB_40_27_ADDR A:0xa0182b0
y.create.l HWIO_WCSS_A_TXFIR_COEFF_TXB_40_28_ADDR A:0xa0182b4
y.create.l HWIO_WCSS_A_TXFIR_COEFF_TXB_40_29_ADDR A:0xa0182b8
y.create.l HWIO_WCSS_A_TXFIR_COEFF_TXB_40_30_ADDR A:0xa0182bc
y.create.l HWIO_WCSS_A_TXFIR_COEFF_TXB_40_31_ADDR A:0xa0182c0
y.create.l HWIO_WCSS_A_TXFIR_COEFF_TXB_80_0_ADDR A:0xa0182c4
y.create.l HWIO_WCSS_A_TXFIR_COEFF_TXB_80_1_ADDR A:0xa0182c8
y.create.l HWIO_WCSS_A_TXFIR_COEFF_TXB_80_2_ADDR A:0xa0182cc
y.create.l HWIO_WCSS_A_TXFIR_COEFF_TXB_80_3_ADDR A:0xa0182d0
y.create.l HWIO_WCSS_A_TXFIR_COEFF_TXB_80_4_ADDR A:0xa0182d4
y.create.l HWIO_WCSS_A_TXFIR_COEFF_TXB_80_5_ADDR A:0xa0182d8
y.create.l HWIO_WCSS_A_TXFIR_COEFF_TXB_80_6_ADDR A:0xa0182dc
y.create.l HWIO_WCSS_A_TXFIR_COEFF_TXB_80_7_ADDR A:0xa0182e0
y.create.l HWIO_WCSS_A_TXFIR_COEFF_TXB_80_8_ADDR A:0xa0182e4
y.create.l HWIO_WCSS_A_TXFIR_COEFF_TXB_80_9_ADDR A:0xa0182e8
y.create.l HWIO_WCSS_A_TXFIR_COEFF_TXB_80_10_ADDR A:0xa0182ec
y.create.l HWIO_WCSS_A_TXFIR_COEFF_TXB_80_11_ADDR A:0xa0182f0
y.create.l HWIO_WCSS_A_TXFIR_COEFF_TXB_80_12_ADDR A:0xa0182f4
y.create.l HWIO_WCSS_A_TXFIR_COEFF_TXB_80_13_ADDR A:0xa0182f8
y.create.l HWIO_WCSS_A_TXFIR_COEFF_TXB_80_14_ADDR A:0xa0182fc
y.create.l HWIO_WCSS_A_TXFIR_COEFF_TXB_80_15_ADDR A:0xa018300
y.create.l HWIO_WCSS_A_TXFIR_COEFF_TXB_80_16_ADDR A:0xa018304
y.create.l HWIO_WCSS_A_TXFIR_COEFF_TXB_80_17_ADDR A:0xa018308
y.create.l HWIO_WCSS_A_TXFIR_COEFF_TXB_80_18_ADDR A:0xa01830c
y.create.l HWIO_WCSS_A_TXFIR_COEFF_TXB_80_19_ADDR A:0xa018310
y.create.l HWIO_WCSS_A_TXFIR_COEFF_TXB_80_20_ADDR A:0xa018314
y.create.l HWIO_WCSS_A_TXFIR_COEFF_TXB_80_21_ADDR A:0xa018318
y.create.l HWIO_WCSS_A_TXFIR_COEFF_TXB_80_22_ADDR A:0xa01831c
y.create.l HWIO_WCSS_A_TXFIR_COEFF_TXB_80_23_ADDR A:0xa018320
y.create.l HWIO_WCSS_A_TXFIR_COEFF_TXB_80_24_ADDR A:0xa018324
y.create.l HWIO_WCSS_A_TXFIR_COEFF_TXB_80_25_ADDR A:0xa018328
y.create.l HWIO_WCSS_A_TXFIR_COEFF_TXB_80_26_ADDR A:0xa01832c
y.create.l HWIO_WCSS_A_TXFIR_COEFF_TXB_80_27_ADDR A:0xa018330
y.create.l HWIO_WCSS_A_TXFIR_COEFF_TXB_80_28_ADDR A:0xa018334
y.create.l HWIO_WCSS_A_TXFIR_COEFF_TXB_80_29_ADDR A:0xa018338
y.create.l HWIO_WCSS_A_TXFIR_COEFF_TXB_80_30_ADDR A:0xa01833c
y.create.l HWIO_WCSS_A_TXFIR_COEFF_TXB_80_31_ADDR A:0xa018340
y.create.l HWIO_WCSS_A_TXFIR_COEFF_TXB_80_32_ADDR A:0xa018344
y.create.l HWIO_WCSS_A_TXFIR_COEFF_TXB_80_33_ADDR A:0xa018348
y.create.l HWIO_WCSS_A_TXFIR_COEFF_TXB_80_34_ADDR A:0xa01834c
y.create.l HWIO_WCSS_A_TXFIR_COEFF_TXB_80_35_ADDR A:0xa018350
y.create.l HWIO_WCSS_A_TXFIR_COEFF_TXB_80_36_ADDR A:0xa018354
y.create.l HWIO_WCSS_A_TXFIR_COEFF_TXB_80_37_ADDR A:0xa018358
y.create.l HWIO_WCSS_A_TXFIR_COEFF_TXB_80_38_ADDR A:0xa01835c
y.create.l HWIO_WCSS_A_TXFIR_COEFF_TXB_80_39_ADDR A:0xa018360
y.create.l HWIO_WCSS_A_TXFIR_COEFF_TXB_80_40_ADDR A:0xa018364
y.create.l HWIO_WCSS_A_TXFIR_COEFF_TXB_80_41_ADDR A:0xa018368
y.create.l HWIO_WCSS_A_TXFIR_COEFF_TXB_80_42_ADDR A:0xa01836c
y.create.l HWIO_WCSS_A_TXFIR_COEFF_TXB_80_43_ADDR A:0xa018370
y.create.l HWIO_WCSS_A_TXFIR_COEFF_TXB_80_44_ADDR A:0xa018374
y.create.l HWIO_WCSS_A_TXFIR_COEFF_TXB_80_45_ADDR A:0xa018378
y.create.l HWIO_WCSS_A_TXFIR_COEFF_TXB_80_46_ADDR A:0xa01837c
y.create.l HWIO_WCSS_A_TXFIR_COEFF_TXB_80_47_ADDR A:0xa018380
y.create.l HWIO_WCSS_A_TXFIR_COEFF_TXB_80_48_ADDR A:0xa018384
y.create.l HWIO_WCSS_A_TXFIR_COEFF_TXB_80_49_ADDR A:0xa018388
y.create.l HWIO_WCSS_A_TXFIR_COEFF_TXB_80_50_ADDR A:0xa01838c
y.create.l HWIO_WCSS_A_TXFIR_COEFF_TXB_80_51_ADDR A:0xa018390
y.create.l HWIO_WCSS_A_TXFIR_COEFF_TXB_80_52_ADDR A:0xa018394
y.create.l HWIO_WCSS_A_TXFIR_COEFF_TXB_80_53_ADDR A:0xa018398
y.create.l HWIO_WCSS_A_TXFIR_COEFF_TXB_80_54_ADDR A:0xa01839c
y.create.l HWIO_WCSS_A_TXFIR_COEFF_TXB_80_55_ADDR A:0xa0183a0
y.create.l HWIO_WCSS_A_TXFIR_COEFF_TXB_80_56_ADDR A:0xa0183a4
y.create.l HWIO_WCSS_A_TXFIR_COEFF_TXB_80_57_ADDR A:0xa0183a8
y.create.l HWIO_WCSS_A_TXFIR_COEFF_TXB_80_58_ADDR A:0xa0183ac
y.create.l HWIO_WCSS_A_TXFIR_COEFF_TXB_80_59_ADDR A:0xa0183b0
y.create.l HWIO_WCSS_A_TXFIR_COEFF_TXB_80_60_ADDR A:0xa0183b4
y.create.l HWIO_WCSS_A_TXFIR_COEFF_TXB_80_61_ADDR A:0xa0183b8
y.create.l HWIO_WCSS_A_TXFIR_COEFF_TXB_80_62_ADDR A:0xa0183bc
y.create.l HWIO_WCSS_A_TXFIR_COEFF_TXB_80_63_ADDR A:0xa0183c0
y.create.l HWIO_WCSS_A_TXFIR_COEFF_PEAKW_0_ADDR A:0xa0183c4
y.create.l HWIO_WCSS_A_TXFIR_COEFF_PEAKW_1_ADDR A:0xa0183c8
y.create.l HWIO_WCSS_A_TXFIR_COEFF_PEAKW_2_ADDR A:0xa0183cc
y.create.l HWIO_WCSS_A_TXFIR_COEFF_PEAKW_3_ADDR A:0xa0183d0
y.create.l HWIO_WCSS_A_TXFIR_COEFF_PEAKW_4_ADDR A:0xa0183d4
y.create.l HWIO_WCSS_A_TXFIR_COEFF_PEAKW_5_ADDR A:0xa0183d8
y.create.l HWIO_WCSS_A_TXFIR_COEFF_PEAKW_6_ADDR A:0xa0183dc
y.create.l HWIO_WCSS_A_TXFIR_COEFF_PEAKW_7_ADDR A:0xa0183e0
y.create.l HWIO_WCSS_A_TXFIR_COEFF_PEAKW_8_ADDR A:0xa0183e4
y.create.l HWIO_WCSS_A_TXFIR_COEFF_PEAKW_9_ADDR A:0xa0183e8
y.create.l HWIO_WCSS_A_TXFIR_COEFF_PEAKW_10_ADDR A:0xa0183ec
y.create.l HWIO_WCSS_A_TXFIR_PEAKW_CLIP_THRESHOLD_0_ADDR A:0xa0183f0
y.create.l HWIO_WCSS_A_TXFIR_PEAKW_CLIP_THRESHOLD_1_ADDR A:0xa0183f4
y.create.l HWIO_WCSS_A_TXFIR_PEAKW_CLIP_THRESHOLD_2_ADDR A:0xa0183f8
y.create.l HWIO_WCSS_A_TXFIR_PEAKW_CLIP_THRESHOLD_3_ADDR A:0xa0183fc
y.create.l HWIO_WCSS_A_TXFIR_PEAKW_CLIP_THRESHOLD_4_ADDR A:0xa018400
y.create.l HWIO_WCSS_A_TXFIR_PEAKW_CLIP_THRESHOLD_5_ADDR A:0xa018404
y.create.l HWIO_WCSS_A_TXFIR_PEAKW_CLIP_THRESHOLD_6_ADDR A:0xa018408
y.create.l HWIO_WCSS_A_TXFIR_PEAKW_CLIP_THRESHOLD_7_ADDR A:0xa01840c
y.create.l HWIO_WCSS_A_TXFIR_PEAKW_CLIP_THRESHOLD_8_ADDR A:0xa018410
y.create.l HWIO_WCSS_A_TXFIR_PEAKW_CLIP_THRESHOLD_9_ADDR A:0xa018414
y.create.l HWIO_WCSS_A_TXFIR_PEAKW_CLIP_THRESHOLD_10_ADDR A:0xa018418
y.create.l HWIO_WCSS_A_TXFIR_PEAKW_CLIP_THRESHOLD_11_ADDR A:0xa01841c
y.create.l HWIO_WCSS_A_TXFIR_PEAKW_CLIP_THRESHOLD_12_ADDR A:0xa018420
y.create.l HWIO_WCSS_A_TXFIR_PEAKW_CLIP_THRESHOLD_13_ADDR A:0xa018424
y.create.l HWIO_WCSS_A_TXFIR_PEAKW_CLIP_THRESHOLD_14_ADDR A:0xa018428
y.create.l HWIO_WCSS_A_TXFIR_PEAKW_CLIP_THRESHOLD_15_ADDR A:0xa01842c
y.create.l HWIO_WCSS_A_TXFIR_PEAKW_CLIP_THRESHOLD_16_ADDR A:0xa018430
y.create.l HWIO_WCSS_A_TXFIR_PEAKW_CLIP_THRESHOLD_17_ADDR A:0xa018434
y.create.l HWIO_WCSS_A_TXFIR_PEAKW_CLIP_THRESHOLD_18_ADDR A:0xa018438
y.create.l HWIO_WCSS_A_TXFIR_PEAKW_CLIP_THRESHOLD_19_ADDR A:0xa01843c
y.create.l HWIO_WCSS_A_TXFIR_PEAKW_CLIP_THRESHOLD_20_ADDR A:0xa018440
y.create.l HWIO_WCSS_A_TXFIR_PEAKW_CLIP_THRESHOLD_21_ADDR A:0xa018444
y.create.l HWIO_WCSS_A_TXFIR_PEAKW_CLIP_THRESHOLD_22_ADDR A:0xa018448
y.create.l HWIO_WCSS_A_TXFIR_PEAKW_CLIP_THRESHOLD_23_ADDR A:0xa01844c
y.create.l HWIO_WCSS_A_TXFIR_PEAKW_CLIP_THRESHOLD_24_ADDR A:0xa018450
y.create.l HWIO_WCSS_A_TXFIR_PEAKW_CLIP_THRESHOLD_25_ADDR A:0xa018454
y.create.l HWIO_WCSS_A_TXFIR_PEAKW_CLIP_THRESHOLD_26_ADDR A:0xa018458
y.create.l HWIO_WCSS_A_TXFIR_PEAKW_CLIP_THRESHOLD_27_ADDR A:0xa01845c
y.create.l HWIO_WCSS_A_TXFIR_PEAKW_CLIP_THRESHOLD_28_ADDR A:0xa018460
y.create.l HWIO_WCSS_A_TXFIR_PEAKW_CLIP_THRESHOLD_29_ADDR A:0xa018464
y.create.l HWIO_WCSS_A_TXFIR_PEAKW_CLIP_THRESHOLD_30_ADDR A:0xa018468
y.create.l HWIO_WCSS_A_TXFIR_PEAKW_CLIP_THRESHOLD_31_ADDR A:0xa01846c
y.create.l HWIO_WCSS_A_TXFIR_Q_INVERT_ADDR A:0xa018470
y.create.l HWIO_WCSS_A_TXFIR_INTERP_X2_ADDR A:0xa018474
y.create.l HWIO_WCSS_A_TXFIR_IQCORR_CENTRE_TAP_ADDR A:0xa018478
y.create.l HWIO_WCSS_A_TXFIR_GAIN_OFFSET_OFDM_ADDR A:0xa01847c
y.create.l HWIO_WCSS_A_TXFIR_FINEGAIN_OFFSET_ADDR A:0xa018480
y.create.l HWIO_WCSS_A_TXFIR_GAIN_OFFSET_11B_ADDR A:0xa018484
y.create.l HWIO_WCSS_A_TXFIR_TXFIR_FIFO_RESET_ADDR A:0xa018488
y.create.l HWIO_WCSS_A_TXFIR_TXCAL_MEM00_0_ADDR A:0xa018800
y.create.l HWIO_WCSS_A_TXFIR_TXCAL_MEM01_0_ADDR A:0xa018820
y.create.l HWIO_WCSS_A_TXFIR_TXCAL_MEM02_0_ADDR A:0xa018840
y.create.l HWIO_WCSS_A_TXFIR_TXCAL_MEM03_0_ADDR A:0xa018860
y.create.l HWIO_WCSS_A_TXFIR_TXCAL_MEM04_0_ADDR A:0xa018880
y.create.l HWIO_WCSS_A_TXFIR_TXCAL_MEM05_0_ADDR A:0xa0188a0
y.create.l HWIO_WCSS_A_TXFIR_TXCAL_MEM06_0_ADDR A:0xa0188c0
y.create.l HWIO_WCSS_A_TXFIR_TXCAL_MEM07_0_ADDR A:0xa0188e0
y.create.l HWIO_WCSS_A_TXFIR_TXCAL_MEM08_0_ADDR A:0xa018900
y.create.l HWIO_WCSS_A_TXFIR_TXCAL_MEM09_0_ADDR A:0xa018920
y.create.l HWIO_WCSS_A_TXFIR_TXCAL_MEM00_1_ADDR A:0xa018804
y.create.l HWIO_WCSS_A_TXFIR_TXCAL_MEM01_1_ADDR A:0xa018824
y.create.l HWIO_WCSS_A_TXFIR_TXCAL_MEM02_1_ADDR A:0xa018844
y.create.l HWIO_WCSS_A_TXFIR_TXCAL_MEM03_1_ADDR A:0xa018864
y.create.l HWIO_WCSS_A_TXFIR_TXCAL_MEM04_1_ADDR A:0xa018884
y.create.l HWIO_WCSS_A_TXFIR_TXCAL_MEM05_1_ADDR A:0xa0188a4
y.create.l HWIO_WCSS_A_TXFIR_TXCAL_MEM06_1_ADDR A:0xa0188c4
y.create.l HWIO_WCSS_A_TXFIR_TXCAL_MEM07_1_ADDR A:0xa0188e4
y.create.l HWIO_WCSS_A_TXFIR_TXCAL_MEM08_1_ADDR A:0xa018904
y.create.l HWIO_WCSS_A_TXFIR_TXCAL_MEM09_1_ADDR A:0xa018924
y.create.l HWIO_WCSS_A_TXFIR_TXCAL_MEM00_2_ADDR A:0xa018808
y.create.l HWIO_WCSS_A_TXFIR_TXCAL_MEM01_2_ADDR A:0xa018828
y.create.l HWIO_WCSS_A_TXFIR_TXCAL_MEM02_2_ADDR A:0xa018848
y.create.l HWIO_WCSS_A_TXFIR_TXCAL_MEM03_2_ADDR A:0xa018868
y.create.l HWIO_WCSS_A_TXFIR_TXCAL_MEM04_2_ADDR A:0xa018888
y.create.l HWIO_WCSS_A_TXFIR_TXCAL_MEM05_2_ADDR A:0xa0188a8
y.create.l HWIO_WCSS_A_TXFIR_TXCAL_MEM06_2_ADDR A:0xa0188c8
y.create.l HWIO_WCSS_A_TXFIR_TXCAL_MEM07_2_ADDR A:0xa0188e8
y.create.l HWIO_WCSS_A_TXFIR_TXCAL_MEM08_2_ADDR A:0xa018908
y.create.l HWIO_WCSS_A_TXFIR_TXCAL_MEM09_2_ADDR A:0xa018928
y.create.l HWIO_WCSS_A_TXFIR_TXCAL_MEM00_3_ADDR A:0xa01880c
y.create.l HWIO_WCSS_A_TXFIR_TXCAL_MEM01_3_ADDR A:0xa01882c
y.create.l HWIO_WCSS_A_TXFIR_TXCAL_MEM02_3_ADDR A:0xa01884c
y.create.l HWIO_WCSS_A_TXFIR_TXCAL_MEM03_3_ADDR A:0xa01886c
y.create.l HWIO_WCSS_A_TXFIR_TXCAL_MEM04_3_ADDR A:0xa01888c
y.create.l HWIO_WCSS_A_TXFIR_TXCAL_MEM05_3_ADDR A:0xa0188ac
y.create.l HWIO_WCSS_A_TXFIR_TXCAL_MEM06_3_ADDR A:0xa0188cc
y.create.l HWIO_WCSS_A_TXFIR_TXCAL_MEM07_3_ADDR A:0xa0188ec
y.create.l HWIO_WCSS_A_TXFIR_TXCAL_MEM08_3_ADDR A:0xa01890c
y.create.l HWIO_WCSS_A_TXFIR_TXCAL_MEM09_3_ADDR A:0xa01892c
y.create.l HWIO_WCSS_A_TXFIR_TXCAL_MEM00_4_ADDR A:0xa018810
y.create.l HWIO_WCSS_A_TXFIR_TXCAL_MEM01_4_ADDR A:0xa018830
y.create.l HWIO_WCSS_A_TXFIR_TXCAL_MEM02_4_ADDR A:0xa018850
y.create.l HWIO_WCSS_A_TXFIR_TXCAL_MEM03_4_ADDR A:0xa018870
y.create.l HWIO_WCSS_A_TXFIR_TXCAL_MEM04_4_ADDR A:0xa018890
y.create.l HWIO_WCSS_A_TXFIR_TXCAL_MEM05_4_ADDR A:0xa0188b0
y.create.l HWIO_WCSS_A_TXFIR_TXCAL_MEM06_4_ADDR A:0xa0188d0
y.create.l HWIO_WCSS_A_TXFIR_TXCAL_MEM07_4_ADDR A:0xa0188f0
y.create.l HWIO_WCSS_A_TXFIR_TXCAL_MEM08_4_ADDR A:0xa018910
y.create.l HWIO_WCSS_A_TXFIR_TXCAL_MEM09_4_ADDR A:0xa018930
y.create.l HWIO_WCSS_A_TXFIR_TXCAL_MEM00_5_ADDR A:0xa018814
y.create.l HWIO_WCSS_A_TXFIR_TXCAL_MEM01_5_ADDR A:0xa018834
y.create.l HWIO_WCSS_A_TXFIR_TXCAL_MEM02_5_ADDR A:0xa018854
y.create.l HWIO_WCSS_A_TXFIR_TXCAL_MEM03_5_ADDR A:0xa018874
y.create.l HWIO_WCSS_A_TXFIR_TXCAL_MEM04_5_ADDR A:0xa018894
y.create.l HWIO_WCSS_A_TXFIR_TXCAL_MEM05_5_ADDR A:0xa0188b4
y.create.l HWIO_WCSS_A_TXFIR_TXCAL_MEM06_5_ADDR A:0xa0188d4
y.create.l HWIO_WCSS_A_TXFIR_TXCAL_MEM07_5_ADDR A:0xa0188f4
y.create.l HWIO_WCSS_A_TXFIR_TXCAL_MEM08_5_ADDR A:0xa018914
y.create.l HWIO_WCSS_A_TXFIR_TXCAL_MEM09_5_ADDR A:0xa018934
y.create.l HWIO_WCSS_A_TXFIR_TXCAL_MEM00_6_ADDR A:0xa018818
y.create.l HWIO_WCSS_A_TXFIR_TXCAL_MEM01_6_ADDR A:0xa018838
y.create.l HWIO_WCSS_A_TXFIR_TXCAL_MEM02_6_ADDR A:0xa018858
y.create.l HWIO_WCSS_A_TXFIR_TXCAL_MEM03_6_ADDR A:0xa018878
y.create.l HWIO_WCSS_A_TXFIR_TXCAL_MEM04_6_ADDR A:0xa018898
y.create.l HWIO_WCSS_A_TXFIR_TXCAL_MEM05_6_ADDR A:0xa0188b8
y.create.l HWIO_WCSS_A_TXFIR_TXCAL_MEM06_6_ADDR A:0xa0188d8
y.create.l HWIO_WCSS_A_TXFIR_TXCAL_MEM07_6_ADDR A:0xa0188f8
y.create.l HWIO_WCSS_A_TXFIR_TXCAL_MEM08_6_ADDR A:0xa018918
y.create.l HWIO_WCSS_A_TXFIR_TXCAL_MEM09_6_ADDR A:0xa018938
y.create.l HWIO_WCSS_A_TXFIR_DPD_MEM00_0_ADDR A:0xa019000
y.create.l HWIO_WCSS_A_TXFIR_DPD_MEM01_0_ADDR A:0xa019010
y.create.l HWIO_WCSS_A_TXFIR_DPD_MEM02_0_ADDR A:0xa019020
y.create.l HWIO_WCSS_A_TXFIR_DPD_MEM03_0_ADDR A:0xa019030
y.create.l HWIO_WCSS_A_TXFIR_DPD_MEM04_0_ADDR A:0xa019040
y.create.l HWIO_WCSS_A_TXFIR_DPD_MEM05_0_ADDR A:0xa019050
y.create.l HWIO_WCSS_A_TXFIR_DPD_MEM06_0_ADDR A:0xa019060
y.create.l HWIO_WCSS_A_TXFIR_DPD_MEM07_0_ADDR A:0xa019070
y.create.l HWIO_WCSS_A_TXFIR_DPD_MEM08_0_ADDR A:0xa019080
y.create.l HWIO_WCSS_A_TXFIR_DPD_MEM09_0_ADDR A:0xa019090
y.create.l HWIO_WCSS_A_TXFIR_DPD_MEM00_1_ADDR A:0xa019004
y.create.l HWIO_WCSS_A_TXFIR_DPD_MEM01_1_ADDR A:0xa019014
y.create.l HWIO_WCSS_A_TXFIR_DPD_MEM02_1_ADDR A:0xa019024
y.create.l HWIO_WCSS_A_TXFIR_DPD_MEM03_1_ADDR A:0xa019034
y.create.l HWIO_WCSS_A_TXFIR_DPD_MEM04_1_ADDR A:0xa019044
y.create.l HWIO_WCSS_A_TXFIR_DPD_MEM05_1_ADDR A:0xa019054
y.create.l HWIO_WCSS_A_TXFIR_DPD_MEM06_1_ADDR A:0xa019064
y.create.l HWIO_WCSS_A_TXFIR_DPD_MEM07_1_ADDR A:0xa019074
y.create.l HWIO_WCSS_A_TXFIR_DPD_MEM08_1_ADDR A:0xa019084
y.create.l HWIO_WCSS_A_TXFIR_DPD_MEM09_1_ADDR A:0xa019094
y.create.l HWIO_WCSS_A_TXFIR_DPD_MEM00_2_ADDR A:0xa019008
y.create.l HWIO_WCSS_A_TXFIR_DPD_MEM01_2_ADDR A:0xa019018
y.create.l HWIO_WCSS_A_TXFIR_DPD_MEM02_2_ADDR A:0xa019028
y.create.l HWIO_WCSS_A_TXFIR_DPD_MEM03_2_ADDR A:0xa019038
y.create.l HWIO_WCSS_A_TXFIR_DPD_MEM04_2_ADDR A:0xa019048
y.create.l HWIO_WCSS_A_TXFIR_DPD_MEM05_2_ADDR A:0xa019058
y.create.l HWIO_WCSS_A_TXFIR_DPD_MEM06_2_ADDR A:0xa019068
y.create.l HWIO_WCSS_A_TXFIR_DPD_MEM07_2_ADDR A:0xa019078
y.create.l HWIO_WCSS_A_TXFIR_DPD_MEM08_2_ADDR A:0xa019088
y.create.l HWIO_WCSS_A_TXFIR_DPD_MEM09_2_ADDR A:0xa019098
y.create.l HWIO_WCSS_A_TXFIR_DPD_MEM00_3_ADDR A:0xa01900c
y.create.l HWIO_WCSS_A_TXFIR_DPD_MEM01_3_ADDR A:0xa01901c
y.create.l HWIO_WCSS_A_TXFIR_DPD_MEM02_3_ADDR A:0xa01902c
y.create.l HWIO_WCSS_A_TXFIR_DPD_MEM03_3_ADDR A:0xa01903c
y.create.l HWIO_WCSS_A_TXFIR_DPD_MEM04_3_ADDR A:0xa01904c
y.create.l HWIO_WCSS_A_TXFIR_DPD_MEM05_3_ADDR A:0xa01905c
y.create.l HWIO_WCSS_A_TXFIR_DPD_MEM06_3_ADDR A:0xa01906c
y.create.l HWIO_WCSS_A_TXFIR_DPD_MEM07_3_ADDR A:0xa01907c
y.create.l HWIO_WCSS_A_TXFIR_DPD_MEM08_3_ADDR A:0xa01908c
y.create.l HWIO_WCSS_A_TXFIR_DPD_MEM09_3_ADDR A:0xa01909c
y.create.l HWIO_WCSS_A_TXP_TXP_CMDF_DIN_ADDR A:0xa080400
y.create.l HWIO_WCSS_A_TXP_TXP_CMDF_CONTROL_ADDR A:0xa080404
y.create.l HWIO_WCSS_A_TXP_TXP_TIMEOUT_TIMER_ADDR A:0xa080408
y.create.l HWIO_WCSS_A_TXP_TXP_STATUS_ADDR A:0xa08040c
y.create.l HWIO_WCSS_A_TXP_TXP_BTC_ACTIVE_ABORT_ENABLE_ADDR A:0xa080410
y.create.l HWIO_WCSS_A_TXP_TXP_TESTBUS_ADDR A:0xa080414
y.create.l HWIO_WCSS_A_TXP_TXP_WARMUP_CNTL_ADDR A:0xa080418
y.create.l HWIO_WCSS_A_TXP_TXP_TXFIFO_CTRL_ADDR A:0xa080420
y.create.l HWIO_WCSS_A_TXP_TXP_DEBUG_CLEAR_ADDR A:0xa080480
y.create.l HWIO_WCSS_A_TXP_TXP_NR_FRAMES_XMIT_ADDR A:0xa080484
y.create.l HWIO_WCSS_A_TXP_TXP_PHY_ABORTS_ADDR A:0xa080488
y.create.l HWIO_WCSS_A_TXP_TXP_NR_END_INTERRUPTS_ADDR A:0xa08048c
y.create.l HWIO_WCSS_A_TXP_TXP_NR_CMDS_ADDR A:0xa080490
y.create.l HWIO_WCSS_A_TXP_TXP_FSM_STATUS_ADDR A:0xa080494
y.create.l HWIO_WCSS_A_TXP_TXP_DBG_STATUS_ADDR A:0xa080498
y.create.l HWIO_WCSS_A_TXP_TXP_NR_MPI_ADDR A:0xa08049c
y.create.l HWIO_XPU_CFG_PCNOC_CFG_XPU_SCR_ADDR A:0x2e000
y.create.l HWIO_XPU_CFG_PCNOC_CFG_XPU_SWDR_ADDR A:0x2e004
y.create.l HWIO_XPU_CFG_PCNOC_CFG_XPU_PRTN_RACR_SSHADOW_ADDR A:0x2e008
y.create.l HWIO_XPU_CFG_PCNOC_CFG_XPU_PRTN_WACR_SSHADOW_ADDR A:0x2e00c
y.create.l HWIO_XPU_CFG_PCNOC_CFG_XPU_PRTN_START_SSHADOW0_ADDR A:0x2e010
y.create.l HWIO_XPU_CFG_PCNOC_CFG_XPU_PRTN_END_SSHADOW0_ADDR A:0x2e018
y.create.l HWIO_XPU_CFG_PCNOC_CFG_XPU_SEAR0_ADDR A:0x2e040
y.create.l HWIO_XPU_CFG_PCNOC_CFG_XPU_SESR_ADDR A:0x2e048
y.create.l HWIO_XPU_CFG_PCNOC_CFG_XPU_SESRRESTORE_ADDR A:0x2e04c
y.create.l HWIO_XPU_CFG_PCNOC_CFG_XPU_SESYNR0_ADDR A:0x2e050
y.create.l HWIO_XPU_CFG_PCNOC_CFG_XPU_SESYNR1_ADDR A:0x2e054
y.create.l HWIO_XPU_CFG_PCNOC_CFG_XPU_SESYNR2_ADDR A:0x2e058
y.create.l HWIO_XPU_CFG_PCNOC_CFG_XPU_MCR_ADDR A:0x2e100
y.create.l HWIO_XPU_CFG_PCNOC_CFG_XPU_MEAR0_ADDR A:0x2e140
y.create.l HWIO_XPU_CFG_PCNOC_CFG_XPU_MESR_ADDR A:0x2e148
y.create.l HWIO_XPU_CFG_PCNOC_CFG_XPU_MESRRESTORE_ADDR A:0x2e14c
y.create.l HWIO_XPU_CFG_PCNOC_CFG_XPU_MESYNR0_ADDR A:0x2e150
y.create.l HWIO_XPU_CFG_PCNOC_CFG_XPU_MESYNR1_ADDR A:0x2e154
y.create.l HWIO_XPU_CFG_PCNOC_CFG_XPU_MESYNR2_ADDR A:0x2e158
y.create.l HWIO_XPU_CFG_PCNOC_CFG_XPU_CR_ADDR A:0x2e080
y.create.l HWIO_XPU_CFG_PCNOC_CFG_XPU_PRTN_RACR_SHADOW_ADDR A:0x2e088
y.create.l HWIO_XPU_CFG_PCNOC_CFG_XPU_PRTN_WACR_SHADOW_ADDR A:0x2e08c
y.create.l HWIO_XPU_CFG_PCNOC_CFG_XPU_PRTN_START_SHADOW0_ADDR A:0x2e090
y.create.l HWIO_XPU_CFG_PCNOC_CFG_XPU_PRTN_END_SHADOW0_ADDR A:0x2e098
y.create.l HWIO_XPU_CFG_PCNOC_CFG_XPU_RPU_ACR0_ADDR A:0x2e0a0
y.create.l HWIO_XPU_CFG_PCNOC_CFG_XPU_EAR0_ADDR A:0x2e0c0
y.create.l HWIO_XPU_CFG_PCNOC_CFG_XPU_ESR_ADDR A:0x2e0c8
y.create.l HWIO_XPU_CFG_PCNOC_CFG_XPU_ESRRESTORE_ADDR A:0x2e0cc
y.create.l HWIO_XPU_CFG_PCNOC_CFG_XPU_ESYNR0_ADDR A:0x2e0d0
y.create.l HWIO_XPU_CFG_PCNOC_CFG_XPU_ESYNR1_ADDR A:0x2e0d4
y.create.l HWIO_XPU_CFG_PCNOC_CFG_XPU_ESYNR2_ADDR A:0x2e0d8
y.create.l HWIO_XPU_CFG_PCNOC_CFG_XPU_UMR_RACR_ADDR A:0x2e0e0
y.create.l HWIO_XPU_CFG_PCNOC_CFG_XPU_UMR_WACR_ADDR A:0x2e0e4
y.create.l HWIO_XPU_CFG_PCNOC_CFG_XPU_UMR_CNTL_ADDR A:0x2e0f0
y.create.l HWIO_XPU_CFG_PCNOC_CFG_XPU_IDR0_ADDR A:0x2e074
y.create.l HWIO_XPU_CFG_PCNOC_CFG_XPU_IDR1_ADDR A:0x2e078
y.create.l HWIO_XPU_CFG_PCNOC_CFG_XPU_REV_ADDR A:0x2e07c
y.create.l HWIO_XPU_CFG_PCNOC_CFG_XPU_PRT0_RACR0_ADDR A:0x2e200
y.create.l HWIO_XPU_CFG_PCNOC_CFG_XPU_PRT1_RACR0_ADDR A:0x2e280
y.create.l HWIO_XPU_CFG_PCNOC_CFG_XPU_PRT2_RACR0_ADDR A:0x2e300
y.create.l HWIO_XPU_CFG_PCNOC_CFG_XPU_PRT3_RACR0_ADDR A:0x2e380
y.create.l HWIO_XPU_CFG_PCNOC_CFG_XPU_PRT0_WACR0_ADDR A:0x2e220
y.create.l HWIO_XPU_CFG_PCNOC_CFG_XPU_PRT1_WACR0_ADDR A:0x2e2a0
y.create.l HWIO_XPU_CFG_PCNOC_CFG_XPU_PRT2_WACR0_ADDR A:0x2e320
y.create.l HWIO_XPU_CFG_PCNOC_CFG_XPU_PRT3_WACR0_ADDR A:0x2e3a0
y.create.l HWIO_XPU_CFG_PCNOC_CFG_XPU_PRT0_START0_ADDR A:0x2e240
y.create.l HWIO_XPU_CFG_PCNOC_CFG_XPU_PRT1_START0_ADDR A:0x2e2c0
y.create.l HWIO_XPU_CFG_PCNOC_CFG_XPU_PRT2_START0_ADDR A:0x2e340
y.create.l HWIO_XPU_CFG_PCNOC_CFG_XPU_PRT3_START0_ADDR A:0x2e3c0
y.create.l HWIO_XPU_CFG_PCNOC_CFG_XPU_PRT0_END0_ADDR A:0x2e248
y.create.l HWIO_XPU_CFG_PCNOC_CFG_XPU_PRT1_END0_ADDR A:0x2e2c8
y.create.l HWIO_XPU_CFG_PCNOC_CFG_XPU_PRT2_END0_ADDR A:0x2e348
y.create.l HWIO_XPU_CFG_PCNOC_CFG_XPU_PRT3_END0_ADDR A:0x2e3c8
y.create.l HWIO_XPU_CFG_PCNOC_CFG_XPU_PRT0_SCR_ADDR A:0x2e250
y.create.l HWIO_XPU_CFG_PCNOC_CFG_XPU_PRT1_SCR_ADDR A:0x2e2d0
y.create.l HWIO_XPU_CFG_PCNOC_CFG_XPU_PRT2_SCR_ADDR A:0x2e350
y.create.l HWIO_XPU_CFG_PCNOC_CFG_XPU_PRT3_SCR_ADDR A:0x2e3d0
y.create.l HWIO_XPU_CFG_PCNOC_CFG_XPU_PRT0_MCR_ADDR A:0x2e254
y.create.l HWIO_XPU_CFG_PCNOC_CFG_XPU_PRT1_MCR_ADDR A:0x2e2d4
y.create.l HWIO_XPU_CFG_PCNOC_CFG_XPU_PRT2_MCR_ADDR A:0x2e354
y.create.l HWIO_XPU_CFG_PCNOC_CFG_XPU_PRT3_MCR_ADDR A:0x2e3d4
y.create.l HWIO_XPU_CFG_PCNOC_CFG_XPU_PRT0_CNTL0_ADDR A:0x2e258
y.create.l HWIO_XPU_CFG_PCNOC_CFG_XPU_PRT1_CNTL0_ADDR A:0x2e2d8
y.create.l HWIO_XPU_CFG_PCNOC_CFG_XPU_PRT2_CNTL0_ADDR A:0x2e358
y.create.l HWIO_XPU_CFG_PCNOC_CFG_XPU_PRT3_CNTL0_ADDR A:0x2e3d8
y.create.l HWIO_XPU_CFG_PCNOC_CFG_XPU_PRT0_CNTL1_ADDR A:0x2e25c
y.create.l HWIO_XPU_CFG_PCNOC_CFG_XPU_PRT1_CNTL1_ADDR A:0x2e2dc
y.create.l HWIO_XPU_CFG_PCNOC_CFG_XPU_PRT2_CNTL1_ADDR A:0x2e35c
y.create.l HWIO_XPU_CFG_PCNOC_CFG_XPU_PRT3_CNTL1_ADDR A:0x2e3dc
y.create.l HWIO_XPU_CFG_PRNG_CFG_XPU_SCR_ADDR A:0x2f000
y.create.l HWIO_XPU_CFG_PRNG_CFG_XPU_SWDR_ADDR A:0x2f004
y.create.l HWIO_XPU_CFG_PRNG_CFG_XPU_SEAR0_ADDR A:0x2f040
y.create.l HWIO_XPU_CFG_PRNG_CFG_XPU_SESR_ADDR A:0x2f048
y.create.l HWIO_XPU_CFG_PRNG_CFG_XPU_SESRRESTORE_ADDR A:0x2f04c
y.create.l HWIO_XPU_CFG_PRNG_CFG_XPU_SESYNR0_ADDR A:0x2f050
y.create.l HWIO_XPU_CFG_PRNG_CFG_XPU_SESYNR1_ADDR A:0x2f054
y.create.l HWIO_XPU_CFG_PRNG_CFG_XPU_SESYNR2_ADDR A:0x2f058
y.create.l HWIO_XPU_CFG_PRNG_CFG_XPU_MCR_ADDR A:0x2f100
y.create.l HWIO_XPU_CFG_PRNG_CFG_XPU_MEAR0_ADDR A:0x2f140
y.create.l HWIO_XPU_CFG_PRNG_CFG_XPU_MESR_ADDR A:0x2f148
y.create.l HWIO_XPU_CFG_PRNG_CFG_XPU_MESRRESTORE_ADDR A:0x2f14c
y.create.l HWIO_XPU_CFG_PRNG_CFG_XPU_MESYNR0_ADDR A:0x2f150
y.create.l HWIO_XPU_CFG_PRNG_CFG_XPU_MESYNR1_ADDR A:0x2f154
y.create.l HWIO_XPU_CFG_PRNG_CFG_XPU_MESYNR2_ADDR A:0x2f158
y.create.l HWIO_XPU_CFG_PRNG_CFG_XPU_CR_ADDR A:0x2f080
y.create.l HWIO_XPU_CFG_PRNG_CFG_XPU_RPU_ACR0_ADDR A:0x2f0a0
y.create.l HWIO_XPU_CFG_PRNG_CFG_XPU_EAR0_ADDR A:0x2f0c0
y.create.l HWIO_XPU_CFG_PRNG_CFG_XPU_ESR_ADDR A:0x2f0c8
y.create.l HWIO_XPU_CFG_PRNG_CFG_XPU_ESRRESTORE_ADDR A:0x2f0cc
y.create.l HWIO_XPU_CFG_PRNG_CFG_XPU_ESYNR0_ADDR A:0x2f0d0
y.create.l HWIO_XPU_CFG_PRNG_CFG_XPU_ESYNR1_ADDR A:0x2f0d4
y.create.l HWIO_XPU_CFG_PRNG_CFG_XPU_ESYNR2_ADDR A:0x2f0d8
y.create.l HWIO_XPU_CFG_PRNG_CFG_XPU_IDR0_ADDR A:0x2f074
y.create.l HWIO_XPU_CFG_PRNG_CFG_XPU_IDR1_ADDR A:0x2f078
y.create.l HWIO_XPU_CFG_PRNG_CFG_XPU_REV_ADDR A:0x2f07c
y.create.l HWIO_XPU_CFG_PRNG_CFG_XPU_RG0_RACR0_ADDR A:0x2f200
y.create.l HWIO_XPU_CFG_PRNG_CFG_XPU_RG0_WACR0_ADDR A:0x2f220
y.create.l HWIO_XPU_CFG_PRNG_CFG_XPU_RG0_SCR_ADDR A:0x2f250
y.create.l HWIO_XPU_CFG_PRNG_CFG_XPU_RG0_MCR_ADDR A:0x2f254
y.create.l HWIO_XPU_CFG_RPM_CFG_XPU_SCR_ADDR A:0x33000
y.create.l HWIO_XPU_CFG_RPM_CFG_XPU_SWDR_ADDR A:0x33004
y.create.l HWIO_XPU_CFG_RPM_CFG_XPU_PRTN_RACR_SSHADOW_ADDR A:0x33008
y.create.l HWIO_XPU_CFG_RPM_CFG_XPU_PRTN_WACR_SSHADOW_ADDR A:0x3300c
y.create.l HWIO_XPU_CFG_RPM_CFG_XPU_PRTN_START_SSHADOW0_ADDR A:0x33010
y.create.l HWIO_XPU_CFG_RPM_CFG_XPU_PRTN_END_SSHADOW0_ADDR A:0x33018
y.create.l HWIO_XPU_CFG_RPM_CFG_XPU_SEAR0_ADDR A:0x33040
y.create.l HWIO_XPU_CFG_RPM_CFG_XPU_SESR_ADDR A:0x33048
y.create.l HWIO_XPU_CFG_RPM_CFG_XPU_SESRRESTORE_ADDR A:0x3304c
y.create.l HWIO_XPU_CFG_RPM_CFG_XPU_SESYNR0_ADDR A:0x33050
y.create.l HWIO_XPU_CFG_RPM_CFG_XPU_SESYNR1_ADDR A:0x33054
y.create.l HWIO_XPU_CFG_RPM_CFG_XPU_SESYNR2_ADDR A:0x33058
y.create.l HWIO_XPU_CFG_RPM_CFG_XPU_MCR_ADDR A:0x33100
y.create.l HWIO_XPU_CFG_RPM_CFG_XPU_MEAR0_ADDR A:0x33140
y.create.l HWIO_XPU_CFG_RPM_CFG_XPU_MESR_ADDR A:0x33148
y.create.l HWIO_XPU_CFG_RPM_CFG_XPU_MESRRESTORE_ADDR A:0x3314c
y.create.l HWIO_XPU_CFG_RPM_CFG_XPU_MESYNR0_ADDR A:0x33150
y.create.l HWIO_XPU_CFG_RPM_CFG_XPU_MESYNR1_ADDR A:0x33154
y.create.l HWIO_XPU_CFG_RPM_CFG_XPU_MESYNR2_ADDR A:0x33158
y.create.l HWIO_XPU_CFG_RPM_CFG_XPU_CR_ADDR A:0x33080
y.create.l HWIO_XPU_CFG_RPM_CFG_XPU_PRTN_RACR_SHADOW_ADDR A:0x33088
y.create.l HWIO_XPU_CFG_RPM_CFG_XPU_PRTN_WACR_SHADOW_ADDR A:0x3308c
y.create.l HWIO_XPU_CFG_RPM_CFG_XPU_PRTN_START_SHADOW0_ADDR A:0x33090
y.create.l HWIO_XPU_CFG_RPM_CFG_XPU_PRTN_END_SHADOW0_ADDR A:0x33098
y.create.l HWIO_XPU_CFG_RPM_CFG_XPU_RPU_ACR0_ADDR A:0x330a0
y.create.l HWIO_XPU_CFG_RPM_CFG_XPU_EAR0_ADDR A:0x330c0
y.create.l HWIO_XPU_CFG_RPM_CFG_XPU_ESR_ADDR A:0x330c8
y.create.l HWIO_XPU_CFG_RPM_CFG_XPU_ESRRESTORE_ADDR A:0x330cc
y.create.l HWIO_XPU_CFG_RPM_CFG_XPU_ESYNR0_ADDR A:0x330d0
y.create.l HWIO_XPU_CFG_RPM_CFG_XPU_ESYNR1_ADDR A:0x330d4
y.create.l HWIO_XPU_CFG_RPM_CFG_XPU_ESYNR2_ADDR A:0x330d8
y.create.l HWIO_XPU_CFG_RPM_CFG_XPU_UMR_RACR_ADDR A:0x330e0
y.create.l HWIO_XPU_CFG_RPM_CFG_XPU_UMR_WACR_ADDR A:0x330e4
y.create.l HWIO_XPU_CFG_RPM_CFG_XPU_UMR_CNTL_ADDR A:0x330f0
y.create.l HWIO_XPU_CFG_RPM_CFG_XPU_IDR0_ADDR A:0x33074
y.create.l HWIO_XPU_CFG_RPM_CFG_XPU_IDR1_ADDR A:0x33078
y.create.l HWIO_XPU_CFG_RPM_CFG_XPU_REV_ADDR A:0x3307c
y.create.l HWIO_XPU_CFG_RPM_CFG_XPU_PRT0_RACR0_ADDR A:0x33200
y.create.l HWIO_XPU_CFG_RPM_CFG_XPU_PRT1_RACR0_ADDR A:0x33280
y.create.l HWIO_XPU_CFG_RPM_CFG_XPU_PRT0_WACR0_ADDR A:0x33220
y.create.l HWIO_XPU_CFG_RPM_CFG_XPU_PRT1_WACR0_ADDR A:0x332a0
y.create.l HWIO_XPU_CFG_RPM_CFG_XPU_PRT0_START0_ADDR A:0x33240
y.create.l HWIO_XPU_CFG_RPM_CFG_XPU_PRT1_START0_ADDR A:0x332c0
y.create.l HWIO_XPU_CFG_RPM_CFG_XPU_PRT0_END0_ADDR A:0x33248
y.create.l HWIO_XPU_CFG_RPM_CFG_XPU_PRT1_END0_ADDR A:0x332c8
y.create.l HWIO_XPU_CFG_RPM_CFG_XPU_PRT0_SCR_ADDR A:0x33250
y.create.l HWIO_XPU_CFG_RPM_CFG_XPU_PRT1_SCR_ADDR A:0x332d0
y.create.l HWIO_XPU_CFG_RPM_CFG_XPU_PRT0_MCR_ADDR A:0x33254
y.create.l HWIO_XPU_CFG_RPM_CFG_XPU_PRT1_MCR_ADDR A:0x332d4
y.create.l HWIO_XPU_CFG_RPM_CFG_XPU_PRT0_CNTL0_ADDR A:0x33258
y.create.l HWIO_XPU_CFG_RPM_CFG_XPU_PRT1_CNTL0_ADDR A:0x332d8
y.create.l HWIO_XPU_CFG_RPM_CFG_XPU_PRT0_CNTL1_ADDR A:0x3325c
y.create.l HWIO_XPU_CFG_RPM_CFG_XPU_PRT1_CNTL1_ADDR A:0x332dc
y.create.l HWIO_XPU_CFG_SNOC_CFG_XPU_SCR_ADDR A:0x2d000
y.create.l HWIO_XPU_CFG_SNOC_CFG_XPU_SWDR_ADDR A:0x2d004
y.create.l HWIO_XPU_CFG_SNOC_CFG_XPU_PRTN_RACR_SSHADOW_ADDR A:0x2d008
y.create.l HWIO_XPU_CFG_SNOC_CFG_XPU_PRTN_WACR_SSHADOW_ADDR A:0x2d00c
y.create.l HWIO_XPU_CFG_SNOC_CFG_XPU_PRTN_START_SSHADOW0_ADDR A:0x2d010
y.create.l HWIO_XPU_CFG_SNOC_CFG_XPU_PRTN_END_SSHADOW0_ADDR A:0x2d018
y.create.l HWIO_XPU_CFG_SNOC_CFG_XPU_SEAR0_ADDR A:0x2d040
y.create.l HWIO_XPU_CFG_SNOC_CFG_XPU_SESR_ADDR A:0x2d048
y.create.l HWIO_XPU_CFG_SNOC_CFG_XPU_SESRRESTORE_ADDR A:0x2d04c
y.create.l HWIO_XPU_CFG_SNOC_CFG_XPU_SESYNR0_ADDR A:0x2d050
y.create.l HWIO_XPU_CFG_SNOC_CFG_XPU_SESYNR1_ADDR A:0x2d054
y.create.l HWIO_XPU_CFG_SNOC_CFG_XPU_SESYNR2_ADDR A:0x2d058
y.create.l HWIO_XPU_CFG_SNOC_CFG_XPU_MCR_ADDR A:0x2d100
y.create.l HWIO_XPU_CFG_SNOC_CFG_XPU_MEAR0_ADDR A:0x2d140
y.create.l HWIO_XPU_CFG_SNOC_CFG_XPU_MESR_ADDR A:0x2d148
y.create.l HWIO_XPU_CFG_SNOC_CFG_XPU_MESRRESTORE_ADDR A:0x2d14c
y.create.l HWIO_XPU_CFG_SNOC_CFG_XPU_MESYNR0_ADDR A:0x2d150
y.create.l HWIO_XPU_CFG_SNOC_CFG_XPU_MESYNR1_ADDR A:0x2d154
y.create.l HWIO_XPU_CFG_SNOC_CFG_XPU_MESYNR2_ADDR A:0x2d158
y.create.l HWIO_XPU_CFG_SNOC_CFG_XPU_CR_ADDR A:0x2d080
y.create.l HWIO_XPU_CFG_SNOC_CFG_XPU_PRTN_RACR_SHADOW_ADDR A:0x2d088
y.create.l HWIO_XPU_CFG_SNOC_CFG_XPU_PRTN_WACR_SHADOW_ADDR A:0x2d08c
y.create.l HWIO_XPU_CFG_SNOC_CFG_XPU_PRTN_START_SHADOW0_ADDR A:0x2d090
y.create.l HWIO_XPU_CFG_SNOC_CFG_XPU_PRTN_END_SHADOW0_ADDR A:0x2d098
y.create.l HWIO_XPU_CFG_SNOC_CFG_XPU_RPU_ACR0_ADDR A:0x2d0a0
y.create.l HWIO_XPU_CFG_SNOC_CFG_XPU_EAR0_ADDR A:0x2d0c0
y.create.l HWIO_XPU_CFG_SNOC_CFG_XPU_ESR_ADDR A:0x2d0c8
y.create.l HWIO_XPU_CFG_SNOC_CFG_XPU_ESRRESTORE_ADDR A:0x2d0cc
y.create.l HWIO_XPU_CFG_SNOC_CFG_XPU_ESYNR0_ADDR A:0x2d0d0
y.create.l HWIO_XPU_CFG_SNOC_CFG_XPU_ESYNR1_ADDR A:0x2d0d4
y.create.l HWIO_XPU_CFG_SNOC_CFG_XPU_ESYNR2_ADDR A:0x2d0d8
y.create.l HWIO_XPU_CFG_SNOC_CFG_XPU_UMR_RACR_ADDR A:0x2d0e0
y.create.l HWIO_XPU_CFG_SNOC_CFG_XPU_UMR_WACR_ADDR A:0x2d0e4
y.create.l HWIO_XPU_CFG_SNOC_CFG_XPU_UMR_CNTL_ADDR A:0x2d0f0
y.create.l HWIO_XPU_CFG_SNOC_CFG_XPU_IDR0_ADDR A:0x2d074
y.create.l HWIO_XPU_CFG_SNOC_CFG_XPU_IDR1_ADDR A:0x2d078
y.create.l HWIO_XPU_CFG_SNOC_CFG_XPU_REV_ADDR A:0x2d07c
y.create.l HWIO_XPU_CFG_SNOC_CFG_XPU_PRT0_RACR0_ADDR A:0x2d200
y.create.l HWIO_XPU_CFG_SNOC_CFG_XPU_PRT1_RACR0_ADDR A:0x2d280
y.create.l HWIO_XPU_CFG_SNOC_CFG_XPU_PRT2_RACR0_ADDR A:0x2d300
y.create.l HWIO_XPU_CFG_SNOC_CFG_XPU_PRT3_RACR0_ADDR A:0x2d380
y.create.l HWIO_XPU_CFG_SNOC_CFG_XPU_PRT0_WACR0_ADDR A:0x2d220
y.create.l HWIO_XPU_CFG_SNOC_CFG_XPU_PRT1_WACR0_ADDR A:0x2d2a0
y.create.l HWIO_XPU_CFG_SNOC_CFG_XPU_PRT2_WACR0_ADDR A:0x2d320
y.create.l HWIO_XPU_CFG_SNOC_CFG_XPU_PRT3_WACR0_ADDR A:0x2d3a0
y.create.l HWIO_XPU_CFG_SNOC_CFG_XPU_PRT0_START0_ADDR A:0x2d240
y.create.l HWIO_XPU_CFG_SNOC_CFG_XPU_PRT1_START0_ADDR A:0x2d2c0
y.create.l HWIO_XPU_CFG_SNOC_CFG_XPU_PRT2_START0_ADDR A:0x2d340
y.create.l HWIO_XPU_CFG_SNOC_CFG_XPU_PRT3_START0_ADDR A:0x2d3c0
y.create.l HWIO_XPU_CFG_SNOC_CFG_XPU_PRT0_END0_ADDR A:0x2d248
y.create.l HWIO_XPU_CFG_SNOC_CFG_XPU_PRT1_END0_ADDR A:0x2d2c8
y.create.l HWIO_XPU_CFG_SNOC_CFG_XPU_PRT2_END0_ADDR A:0x2d348
y.create.l HWIO_XPU_CFG_SNOC_CFG_XPU_PRT3_END0_ADDR A:0x2d3c8
y.create.l HWIO_XPU_CFG_SNOC_CFG_XPU_PRT0_SCR_ADDR A:0x2d250
y.create.l HWIO_XPU_CFG_SNOC_CFG_XPU_PRT1_SCR_ADDR A:0x2d2d0
y.create.l HWIO_XPU_CFG_SNOC_CFG_XPU_PRT2_SCR_ADDR A:0x2d350
y.create.l HWIO_XPU_CFG_SNOC_CFG_XPU_PRT3_SCR_ADDR A:0x2d3d0
y.create.l HWIO_XPU_CFG_SNOC_CFG_XPU_PRT0_MCR_ADDR A:0x2d254
y.create.l HWIO_XPU_CFG_SNOC_CFG_XPU_PRT1_MCR_ADDR A:0x2d2d4
y.create.l HWIO_XPU_CFG_SNOC_CFG_XPU_PRT2_MCR_ADDR A:0x2d354
y.create.l HWIO_XPU_CFG_SNOC_CFG_XPU_PRT3_MCR_ADDR A:0x2d3d4
y.create.l HWIO_XPU_CFG_SNOC_CFG_XPU_PRT0_CNTL0_ADDR A:0x2d258
y.create.l HWIO_XPU_CFG_SNOC_CFG_XPU_PRT1_CNTL0_ADDR A:0x2d2d8
y.create.l HWIO_XPU_CFG_SNOC_CFG_XPU_PRT2_CNTL0_ADDR A:0x2d358
y.create.l HWIO_XPU_CFG_SNOC_CFG_XPU_PRT3_CNTL0_ADDR A:0x2d3d8
y.create.l HWIO_XPU_CFG_SNOC_CFG_XPU_PRT0_CNTL1_ADDR A:0x2d25c
y.create.l HWIO_XPU_CFG_SNOC_CFG_XPU_PRT1_CNTL1_ADDR A:0x2d2dc
y.create.l HWIO_XPU_CFG_SNOC_CFG_XPU_PRT2_CNTL1_ADDR A:0x2d35c
y.create.l HWIO_XPU_CFG_SNOC_CFG_XPU_PRT3_CNTL1_ADDR A:0x2d3dc
y.create.done
