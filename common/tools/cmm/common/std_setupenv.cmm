//============================================================================
//  Name:                                                                     
//    std_sessioncfg_rpm.cmm 
//
//  Description:                                                              
//    Script to setup sub-system level features
//                                                                            
// Copyright (c) 2012 - 2014 by Qualcomm Technologies, Incorporated.  All Rights Reserved.        
//
//
//
//
//                      EDIT HISTORY FOR FILE
//  This section contains comments describing changes made to the module.
//  Notice that changes are listed in reverse chronological order.
//
// when       who     		what, where, why
// --------   ---     		---------------------------------------------------------
// 07/10/2012 AJCheriyan    Created for B-family (ported from A-family script (AJCheriyan/byule))
//


SETUPT32ENV:
   // Set the window and other common preferences
   
   TOOLBAR ON
   STATUSBAR ON
   WINCLEAR
   WINPOS 0.0 0.0 69% 60% 12. 1. W000
   WINTABS 10. 10. 25. 62.
   DATA.LIST
   
   AREA.RESET
   AREA.CREATE
   WINPOS 0. 63% 69% 41% 0. 0. W001
   AREA.CLEAR
   AREA.VIEW
   AREA.SELECT


   WINPOS 69% 0. 31% 50% 0. 0. W002
   REGISTER /SPOTLIGHT
    
   WINPOS  69% 50% 31% 50% 0. 0. W003
   VAR.FRAME /LOCALS /CALLER
    
   AREA.CREATE
   WINPOS 0. 63% 69% 41% 0. 0. W004
   AREA.CLEAR

   SETUP.VAR %OPEN.ON %HEX %SYMBOL
   GOTO EXIT

EXIT:
   ENDDO
   


