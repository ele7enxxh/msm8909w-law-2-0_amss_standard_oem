ENTRY &ARG0

GLOBAL &HLOS_TYPE
GLOBAL &TZ_BUILDID
GLOBAL &CHIPID
GLOBAL &MPSS_ELF
GLOBAL &TZ_PATH
GLOBAL &KEYMASTER_BINARY
GLOBAL &APPS_ELF
GLOBAL &MBA_BINARY
GLOBAL &TZ_ELF
GLOBAL &MPSS_BINARY
GLOBAL &APPSBOOT_BINARY
GLOBAL &MBA_ELF
GLOBAL &VENUS_BINARY
GLOBAL &RPM_ELF
GLOBAL &CMNLIB_BINARY
GLOBAL &QSEE_BINARY
GLOBAL &WCNSS_BINARY
GLOBAL &APPSBOOT_ELF
GLOBAL &APPS_BINARY
GLOBAL &VENUS_ELF
GLOBAL &MPSS_ORIG_ELF
GLOBAL &WCNSS_ELF
GLOBAL &RPM_BINARY
GLOBAL &BOOT_ELF
GLOBAL &BOOT_BINARY

IF ("&ARG0"=="asic")
(
	&PRODUCT_FLAVOR="asic"
	&HLOS_TYPE="LW"
	&TZ_BUILDID="MATAANAA"
	&CHIPID="msm8909w"
	&MPSS_ELF="modem_proc/build/bsp/mapss_b/build/8909.gpss.prod/MODEM_PROC_IMG_8909.gpss.prodQ.elf"
	&TZ_PATH="trustzone_images/build/ms/bin/MATAANAA/sampleapp.mbn"
	&KEYMASTER_BINARY="trustzone_images/build/ms/bin/MATAANAA/keymaster.mbn"
	&APPS_ELF="out/target/product/msm8909w/obj/KERNEL_OBJ/vmlinux"
	&MBA_BINARY="modem_proc/build/ms/bin/8909.gpss.prod/mba.mbn"
	&TZ_ELF="trustzone_images/core/bsp/tzbsp/build/MATAANAA/tz.elf"
	&MPSS_BINARY="modem_proc/build/ms/bin/8909.gpss.prod/qdsp6sw.mbn"
	&APPSBOOT_BINARY="out/target/product/msm8909w/emmc_appsboot.mbn"
	&MBA_ELF="modem_proc/core/bsp/mba_img/build/8909.gpss.prod/MBA_CORE_IMG_8909.gpss.prodQ.elf"
	&VENUS_BINARY="venus_proc/build/bsp/asic/build/PROD/mbn/reloc/signed/venus.mbn"
	&RPM_ELF="rpm_proc/core/bsp/rpm/build/8909W/pm8916/RPM_AAAAANAAR.elf"
	&CMNLIB_BINARY="trustzone_images/build/ms/bin/MATAANAA/cmnlib.mbn"
	&QSEE_BINARY="trustzone_images/build/ms/bin/MATAANAA/tz.mbn"
	&QSEE_BINARY="trustzone_images/build/ms/bin/MATAANAA/tz.mbn"
	&WCNSS_BINARY="wcnss_proc/build/ms/bin/SCAQDAZ/reloc/wcnss.mbn"
	&APPSBOOT_ELF="out/target/product/msm8909w/obj/EMMC_BOOTLOADER_OBJ/build-msm8909/lk"
	&APPS_BINARY="out/target/product/msm8909w/obj/KERNEL_OBJ/vmlinux"
	&VENUS_ELF="venus_proc/build/bsp/asic/build/PROD/venus.elf"
	&MPSS_ORIG_ELF="modem_proc/build/ms/orig_MODEM_PROC_IMG_8909.gpss.prodQ.elf"
	&WCNSS_ELF="wcnss_proc/build/ms/8909_PRONTO_SCAQDAZM.elf"
	&RPM_BINARY="rpm_proc/build/ms/bin/8909W/pm8916/rpm.mbn"
	&BOOT_ELF="boot_images/core/bsp/bootloaders/sbl1/build/WAASANAZ/SBL1_emmc.elf"
	&BOOT_BINARY="boot_images/build/ms/bin/8909w/emmc/sbl1.mbn"
)
ENDDO