//============================================================================
//  Name:                                                                     
//    std_savelogs_wcnss.cmm 
//
//  Description:                                                              
//    Script to save WCNSS memory locations
//                                                                            
// Copyright (c) 2012 - 2014 by Qualcomm Technologies, Incorporated.  All Rights Reserved.        
//
//
//
//
//                      EDIT HISTORY FOR FILE
//  This section contains comments describing changes made to the module.
//  Notice that changes are listed in reverse chronological order.
//
// when       who     		what, where, why
// --------   ---     		---------------------------------------------------------
// 09/27/2012 AJCheriyan    Created for B-family 


// We support one argument for this script
// &ARG0 - Output location for the logs
ENTRY &ARG0

LOCAL &LOGLOCATION

MAIN:
	&LOGLOCATION="&ARG0"

	// Sanity check
	IF ("&LOGLOCATION"=="")
	(
	    PRINT %ERROR "Location to save logs not provided"
		GOTO FATALEXIT
	)

	// Load the memory map
	do std_memorymap wcnss

	// Flush the caches or anything else we need to do 
	// before we save the binaries 
	GOSUB SYNCSTATE

	// Save the memories first
	GOSUB SAVEBIN

	// Save the registers
	GOSUB SAVESTATE

	GOTO EXIT

SAVEBIN:
	
;	do std_utils SAVEBIN &LOGLOCATION &SHARED_IMEM_log &SHARED_IMEM_start &SHARED_IMEM_size
;	do std_utils SAVEBIN &LOGLOCATION &WCNSS_SW_log &WCNSS_SW_start &WCNSS_SW_size
    do std_intercom_init CHECKSESSION 1 APPS0
	PRINT "Detecting APPS T32 session. Will exit if not found. "
	do std_utils CHECKARGS FATALEXIT &APPS0_ALIVE 1.
	;do std_intercom_do &APPS0_PORT std_utils BREAKPROC
	
	LOCAL &FULLPATH 
	&FULLPATH="&LOGLOCATION"+"/&SHARED_IMEM_log"
	INTERCOM.EXECUTE &WCNSS_PORT data.save.binary &FULLPATH EAXI:&SHARED_IMEM_start++(&SHARED_IMEM_size-1)
	;data.save.binary &FULLPATH EAXI:&SHARED_IMEM_start++(&SHARED_IMEM_size-1)
	LOCAL &FULLPATH 
	&FULLPATH="&LOGLOCATION"+"/&WCNSS_SW_log"
	INTERCOM.EXECUTE &WCNSS_PORT data.save.binary &FULLPATH EZ:&WCNSS_SW_start++(&WCNSS_SW_size-1)
	;data.save.binary &FULLPATH EZ:&WCNSS_SW_start++(&WCNSS_SW_size-1)
	RETURN

SYNCSTATE:
	// Flush the cache
	do std_flushcache ARM9
	RETURN 

SAVESTATE:
	do std_intercom_do &WCNSS_PORT std_utils SAVEREGS &LOGLOCATION &WCNSS_regs
	do std_intercom_do &WCNSS_PORT std_utils SAVEMMU ARM &LOGLOCATION &WCNSS_mmu
	RETURN


FATALEXIT:
	END

EXIT:
	ENDDO

