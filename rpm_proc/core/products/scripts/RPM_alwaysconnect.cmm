//============================================================================
//  Name:                                                                     
//    RPM_alwaysconnect.cmm 
//
//  Description:                                                              
//    Script to ensure RPM T32 session automatically attaches across vdd min
//                                                                            
// Copyright (c) 2012 - 2014 by Qualcomm Technologies, Incorporated.  All Rights Reserved.        
//
//
//
//
//                      EDIT HISTORY FOR FILE
//  This section contains comments describing changes made to the module.
//  Notice that changes are listed in reverse chronological order.
//
// when       who     		what, where, why
// --------   ---     		---------------------------------------------------------
// 06/10/2013 AJCheriyan    Checked in RPM 1.0




ON SYSDOWN GOSUB
(
	WAIT 10MS

	ON ERROR GOSUB
	(
		RETURN
	)

	WHILE SYSTEM.MODE()<6.
		SYSTEM.MODE ATTACH

	RETURN
)
STOP

ENDDO

