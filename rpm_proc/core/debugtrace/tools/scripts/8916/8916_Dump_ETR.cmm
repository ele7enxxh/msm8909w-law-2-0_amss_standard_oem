;****************************************************************************
;** Dumps ETR contents to a binary file.
;**         
;** Usage: do detr [<dumpfile>] [<loglevel>]
;**
;**  Each invocation dumps data collected in ETR since the last dump
;**    
;**  Optional Arguments
;**      
;**    dumpfile - If not specified will dump to etr_<date_time>.bin in 
;**               the temp direcotry. (eg. C:\TEMP\etr_2012_12_7_15_21_26.bin)
;**
;**    loglevel - Optional argument to display debug messages             
;**               To specify the second argument the first argument is necessary
;** 
;** Copyright (c) 2012 by Qualcomm Technologies Incorporated.  All Rights Reserved.
;**
;****************************************************************************
;**                        EDIT HISTORY FOR MODULE
;**
;**
;** when       who     what, where, why
;** --------   ---     ------------------------------------------------------
;** 12/07/12   jk     First revision
;

//Setting this flag result in dumping the ETR buffer directly from memory
//instead of reading throug RRD register.
//This is faster, but it is not the recommended procedure in the manual
GLOBAL &etr_dump_mem
&etr_dump_mem=1


&etr_base=0x00826000          //append 0x6 at start i.e. 0x60826000 for RPM.
&etr_size_reg=&etr_base+0x4    //etr size
&sts_reg=&etr_base+0xC       //status
&rrd_reg=&etr_base+0x10      //read data
&rrp_reg=&etr_base+0x14      //read pointer
&rwp_reg=&etr_base+0x18      //write pointer
&ctl_reg=&etr_base+0x20      //control
&ffcr_reg=&etr_base+0x304    //ffcr
&lar_reg=&etr_base+0xFB0     //lock access
&dba_reg=&etr_base+0x118    //data buffer base address

//area for dump_etr
area.Create dump_etr 
area.Select dump_etr 
area.view dump_etr

entry &dump_file &log_level

if (""=="&dump_file")
(
      gosub GetDumpFileName
      entry &dump_file
)

if (""=="&log_level")
(
        &log_level=0
)

GLOBAL &control_saved &status_saved &ffcr_saved 
d.s edap:&lar_reg %LONG 0xC5ACCE55   // Unlock ETR 
gosub SaveState

GLOBAL &restored_state
&restored_state=0
on ERROR gosub RestoreState

gosub PrintState

gosub StopTMC 

gosub PrintState
gosub PrintPointers

var.if (&etr_dump_mem) 
(
        gosub DumpETR &dump_file
)
else 
(
        gosub ReadETR &dump_file
)
gosub PrintPointers

gosub RestoreState 
gosub PrintState

d.s edap:&lar_reg %LONG 0x3A5331AA   // Lock ETR 

if (file.exist(&dump_file))
(
        &dump_file=os.file.path(&dump_file)+"\"+os.file.name(&dump_file)
        print "Dump File:"
        print ""
        print "&dump_file"
        gosub SaveLastDumpFileName &dump_file
)


print "____________________________"
enddo



;----------
SaveState:
&control_saved=data.long(edap:&ctl_reg)       
&status_saved=data.long(edap:&sts_reg)
&ffcr_saved=data.long(edap:&ffcr_reg)       
return 

;----------
RestoreState:
if (0==&restored_state)
(
    &restored_state=1
    if (1==(&control_saved&0x1))
    (
       print "Resuming ETR ..."

       //Renable trace capture if it was already enabled
        &control=&control_saved&0xFFFFFFFE
        d.s edap:&ctl_reg %LONG &control    // Disable capture

         gosub WaitForTMCReady
         d.s edap:&ffcr_reg %LONG &ffcr_saved	//Restore FFCR
       d.s edap:&ctl_reg %LONG &control_saved   //Write 1 to enable capture again
       print "                  ... Done"
    )
    else
    (
       d.s edap:&ffcr_reg %LONG &ffcr_saved	//Restore FFCR
    )
)
return

;----------
PrintState:
if (&log_level>0)
(
        &control=data.long(edap:&ctl_reg)       
        &status=data.long(edap:&sts_reg)
        &ffcr=data.long(edap:&ffcr_reg)       
        print  "CONTROL: "  &control_saved "   STATUS: "  &status " FFCR: " &ffcr
)
return

;----------
PrintPointers:
if (&log_level>0)
(
        &write_ptr=data.long(edap:&rwp_reg)
        &read_ptr=data.long(edap:&rrp_reg)
        print "READ PTR: "  &read_ptr " WRITE PTR: " &write_ptr
)
return


;----------
ReadETR:
entry &dump_file
local &i
local &data
print "Reading ETR ..."
&i=0
&data=data.long(edap:&rrd_reg)
while &data!=0xffffffff
(
   Data.Set AVM:&i %Long &data
   &i=&i+4
   if (&log_level>2)
   (
        &read_ptr=data.long(edap:&rrp_reg)
	     print "read_ptr: " &read_ptr ";  i: " &i
   )
   &data=data.long(edap:&rrd_reg)
)
print %d "                  ... " &i  " bytes"
Data.Save.Binary &dump_file (AVM:0x0++(&i-1))
return




;----------
DumpETR:
entry &dump_file
&buf_base=data.long(edap:&dba_reg)
&buf_size=data.long(edap:&etr_size_reg)
&buf_size=&buf_size*4
&write_ptr=data.long(edap:&rwp_reg)
&read_ptr=data.long(edap:&rrp_reg)
&status=data.long(edap:&sts_reg)
&count=0


var.if (&status&0x1)
(
        if (&log_level>0)
        ( 
            print "ETR buffer FULL"
        )
        ;save the end of the buffer
        &dump_size=&buf_size-(&write_ptr-&buf_base)
        data.save.binary c:\TEMP\etr0.bin (eahb:&write_ptr++(&dump_size-1)) /long
        
        &count=&dump_size
        ;save the beginning of the buffer
        &dump_size=&write_ptr-&buf_base
        &count=&dump_size+&count
        data.save.binary c:\TEMP\etr1.bin (eahb:&buf_base++(&dump_size-1)) /long

        ;combine them
        os.hidden copy /b c:\temp\etr0.bin + c:\temp\etr1.bin &dump_file
        os.hidden del c:\temp\etr0.bin c:\temp\etr1.bin
)
else
(
        if (&log_level>0)
        (
                print "ETR buffer not full"
        )
        &dump_size=&write_ptr-&buf_base
        data.save.binary &dump_file (eahb:&buf_base++(&dump_size-1)) /long
        &count=&dump_size
)
print ""
print %d  "Saved             ... "  &count " bytes"
print ""
return





;----------
StopTMC:
print "Stopping ETR ..."

&ffcr=data.long(edap:&ffcr_reg)       
&ffcr=&ffcr|0x1000
d.s edap:&ffcr_reg %LONG &ffcr		// Enable Stop on Flush
&ffcr=&ffcr|0x40			//Set FlushMan to flush 
d.s edap:&ffcr_reg %LONG &ffcr	//This will also stop the formatter.

gosub WaitForTMCReady

print "                  ... Done"

return 


;----------
WaitForTMCReady:
local &status
local &i

if (&log_level>1)
(
        print "Waiting for TMCReady"
)
//Wait for TMCReady is 1
&status=data.long(edap:&sts_reg)
&i=0
while (0==(&status&4))
(
	WAIT 10.ms
	&status=data.long(edap:&sts_reg)
	i++
)	
if (&log_level>1)
(
        print  " TMCready after " &i " cycles"
)
return

;----------
GetDumpFileName:
local &tmp
local &fname

&fname=os.ptd()+"\etr"

&tmp=clock.year()
&tmp=string.cut("&tmp",-1)
&fname="&fname"+"_"+"&tmp"

&tmp=clock.month()
&tmp=string.cut("&tmp",-1)
&fname="&fname"+"_"+"&tmp"

&tmp=clock.day()
&tmp=string.cut("&tmp",-1)
&fname="&fname"+"_"+"&tmp"

&time=clock.time()
&hours=string.cut("&time",-6)
&minutes=string.cut(string.cut("&time",3),-3)
&seconds=string.cut("&time",6)
&time="&hours"+"_"+"&minutes"+"_"+"&seconds"


&fname="&fname"+"_"+"&time"+".bin"

return &fname


;------------
SaveLastDumpFileName:
entry &dump_file
&lastdump=os.ptd()+"\qdss_lastdump.txt"
open #1 "&lastdump" /Create
write #1 "&dump_file"
close #1
return


























