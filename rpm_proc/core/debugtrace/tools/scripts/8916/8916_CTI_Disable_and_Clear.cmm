;****************************************************************************
;** Configure CTI for a specific use case
;**         
;**
;** Copyright (c) 2012 by Qualcomm Technologies Incorporated. All Rights Reserved.
;**
;****************************************************************************
;**  $Header: //components/rel/rpm.bf/2.1.1/core/debugtrace/tools/scripts/8916/8916_CTI_Disable_and_Clear.cmm#1 $
;**                        EDIT HISTORY FOR MODULE
;**
;**
;** when       who     what, where, why
;** --------   ---     ------------------------------------------------------
;** 11/04/13   jb     Transferred to using products scripts located in <metabuild>\common\tools\cmm
;** 03/13/13   jb     Logic Update for 8974, added for 9x25, 8x26
;** 09/07/12   ps     First revision of CTI for Aragorn(8974)


do std_utils ClearCTITrig RPM
do std_utils ClearCTITrig ADSP
do std_utils ClearCTITrig APPS0
do std_utils ClearCTITrig APPS1
do std_utils ClearCTITrig APPS2
do std_utils ClearCTITrig APPS3
do std_utils ClearCTITrig VPU

enddo
