
;============================================================================
;
; *************** THIS SCRIPT WAS AUTOGENERATED - 5/17/2013 *****************
;
; TARGET
;   mdm9x25
;
; SCRIPT
;   testpll.cmm - MSS
;
; GENERAL DESCRIPTION
;   This script can be used to lookup PLL config/status/frequency values.
;
; FUNCTIONS
;   N/A
;
; INITIALIZATION AND SEQUENCING REQUIREMENTS
;
;      Copyright (c) 2013 by Qualcomm Technologies, Inc.  All Rights Reserved.
;============================================================================

;-----------------------------------------------------------------------------
; Local variables
;-----------------------------------------------------------------------------
local &subscript
local &is_mpss
local &is_q6

;-----------------------------------------------------------------------------
; Define the window
;-----------------------------------------------------------------------------
&subscript=0

ENTRY &subscript

if "&subscript"==""
(
  AREA.RESet
  WINPOS 0. 0. 100% 100%
  AREA.Create CLOCK
  AREA.view CLOCK
)

AREA.Select CLOCK
AREA.Clear CLOCK


;-----------------------------------------------------------------------------
; Error handler
;-----------------------------------------------------------------------------

on ERROR gosub
(
  print "An Error has Occurred"
  
  return
)


print ""
print ""
print "[------------------------------------------------- TEST PLL TOOL -------------------------------------------------]"
print ""

goto Init_Constants
Init_Constants_Done:

;-----------------------------------------------------------------------------
; Main Menu
;-----------------------------------------------------------------------------

Main_Menu:

print "1: Configurations"
print "2: Votes"
print "3: Mode/Status Dump"
print ""
print "x: Exit"
print ""

print "Enter option:"
enter &choice
print "&choice"

if "&choice"=="x"
(
  if "&subscript"==""
  (
    AREA.CLEAR CLOCK
    AREA.RESET
    WINCLEAR
    term.close 
  )
  
  enddo (0==0)
)
else if &choice==1
(
  gosub Display_Configurations
)
else if &choice==2
(
  gosub Display_Votes
)
else if &choice==3
(
  gosub Display_Dump
)
else
(
  print "Invalid selection"
)

GOTO Main_Menu


;-----------------------------------------------------------------------------
; Sub-functions
;-----------------------------------------------------------------------------

Init_Constants:

  &is_mpss=0
  &is_q6=0

  &HWIO_PLL_L_VAL_MASK=0xFF
  &HWIO_PLL_ALPHA_VAL_MASK=0xFFFFFFFF
  &HWIO_PLL_ALPHA_U_VAL_MASK=0xFF

  ; GCC PLL Vote Registers
  &HWIO_GCC_RPM_GPLL_ENA_VOTE_ADDR=0xFC401440
  &HWIO_GCC_APCS_GPLL_ENA_VOTE_ADDR=0xFC401480
  &HWIO_GCC_APCS_TZ_GPLL_ENA_VOTE_ADDR=0xFC4014C0
  &HWIO_GCC_MSS_Q6_GPLL_ENA_VOTE_ADDR=0xFC401500
  &HWIO_GCC_LPASS_DSP_GPLL_ENA_VOTE_ADDR=0xFC401540
  &HWIO_GCC_SPARE_GPLL_ENA_VOTE_ADDR=0xFC4015C0

  ; LPASS PLL Vote Registers
  &HWIO_LPASS_LPA_PLL_VOTE_APPS_ADDR=0xFE002000
  &HWIO_LPASS_LPA_PLL_VOTE_LPASSQ6_ADDR=0xFE003000
  
  ; PLL0 - GPLL0
  &HWIO_GCC_GPLL0_MODE_ADDR=0xFC400000
  &HWIO_GCC_GPLL0_L_VAL_ADDR=0xFC400004
  &HWIO_GCC_GPLL0_ALPHA_VAL_ADDR=0xFC400008
  &HWIO_GCC_GPLL0_ALPHA_U_VAL_ADDR=0xFC40000C
  &HWIO_GCC_GPLL0_USER_CTL_ADDR=0xFC400010
  &HWIO_GCC_GPLL0_USER_CTL_U_ADDR=0xFC400014
  &HWIO_GCC_GPLL0_CONFIG_CTL_ADDR=0xFC400018
  &HWIO_GCC_GPLL0_TEST_CTL_ADDR=0xFC40001C
  &HWIO_GCC_GPLL0_TEST_CTL_U_ADDR=0xFC400020
  &HWIO_GCC_GPLL0_STATUS_ADDR=0xFC400024

 ; PLL1 - GPLL1
  &HWIO_GCC_GPLL1_MODE_ADDR=0xFC400040
  &HWIO_GCC_GPLL1_L_VAL_ADDR=0xFC400044
  &HWIO_GCC_GPLL1_ALPHA_VAL_ADDR=0xFC400048
  &HWIO_GCC_GPLL1_ALPHA_U_VAL_ADDR=0xFC40004C
  &HWIO_GCC_GPLL1_USER_CTL_ADDR=0xFC400050
  &HWIO_GCC_GPLL1_USER_CTL_U_ADDR=0xFC400054
  &HWIO_GCC_GPLL1_CONFIG_CTL_ADDR=0xFC400058
  &HWIO_GCC_GPLL1_TEST_CTL_ADDR=0xFC40005C
  &HWIO_GCC_GPLL1_TEST_CTL_U_ADDR=0xFC400060
  &HWIO_GCC_GPLL1_STATUS_ADDR=0xFC400064
  
  ; PLL2 - GPLL2
  &HWIO_GCC_GPLL2_MODE_ADDR=0xFC400080
  &HWIO_GCC_GPLL2_L_VAL_ADDR=0xFC400084
  &HWIO_GCC_GPLL2_ALPHA_VAL_ADDR=0xFC400088
  &HWIO_GCC_GPLL2_ALPHA_U_VAL_ADDR=0xFC40008C
  &HWIO_GCC_GPLL2_USER_CTL_ADDR=0xFC400090
  &HWIO_GCC_GPLL2_USER_CTL_U_ADDR=0xFC400094
  &HWIO_GCC_GPLL2_CONFIG_CTL_ADDR=0xFC400098
  &HWIO_GCC_GPLL2_TEST_CTL_ADDR=0xFC40009C
  &HWIO_GCC_GPLL2_TEST_CTL_U_ADDR=0xFC4000A0
  &HWIO_GCC_GPLL2_STATUS_ADDR=0xFC4000A4
  
  ; PLL3 - GPLL3
  &HWIO_GCC_GPLL3_MODE_ADDR=0xFC4000C0
  &HWIO_GCC_GPLL3_L_VAL_ADDR=0xFC4000C4
  &HWIO_GCC_GPLL3_ALPHA_VAL_ADDR=0xFC4000C8
  &HWIO_GCC_GPLL3_ALPHA_U_VAL_ADDR=0xFC4000CC
  &HWIO_GCC_GPLL3_USER_CTL_ADDR=0xFC4000D0
  &HWIO_GCC_GPLL3_USER_CTL_U_ADDR=0xFC4000D4
  &HWIO_GCC_GPLL3_CONFIG_CTL_ADDR=0xFC4000D8
  &HWIO_GCC_GPLL3_TEST_CTL_ADDR=0xFC4000DC
  &HWIO_GCC_GPLL3_TEST_CTL_U_ADDR=0xFC4000E0
  &HWIO_GCC_GPLL3_STATUS_ADDR=0xFC4000E4
  
  ; PLL4 - MPLL0
  &HWIO_MSS_OFFLINE_PLL_MODE_ADDR=0xFC981000
  &HWIO_MSS_OFFLINE_PLL_L_VAL_ADDR=0xFC981004
  &HWIO_MSS_OFFLINE_PLL_ALPHA_VAL_ADDR=0xFC981008
  &HWIO_MSS_OFFLINE_PLL_ALPHA_U_VAL_ADDR=0xFC98100C
  &HWIO_MSS_OFFLINE_PLL_USER_CTL_ADDR=0xFC981010
  &HWIO_MSS_OFFLINE_PLL_USER_CTL_U_ADDR=0xFC981014
  &HWIO_MSS_OFFLINE_PLL_CONFIG_CTL_ADDR=0xFC981018
  &HWIO_MSS_OFFLINE_PLL_TEST_CTL_ADDR=0xFC98101C
  &HWIO_MSS_OFFLINE_PLL_TEST_CTL_U_ADDR=0xFC981020
  &HWIO_MSS_OFFLINE_PLL_STATUS_ADDR=0xFC981024
  
  ; PLL5 - MPLL1
  &HWIO_PLL1_MODE_ADDR=0x100000000
  &HWIO_PLL1_L_VAL_ADDR=0x100000008
  &HWIO_PLL1_ALPHA_VAL_L_ADDR=0x100000010
  &HWIO_PLL1_ALPHA_VAL_H_ADDR=0x100000018
  &HWIO_PLL1_USER_CTL_ADDR=0x100000020
  &HWIO_PLL1_CONFIG_CTL_ADDR=0x100000028
  &HWIO_PLL1_TEST_CTL_ADDR=0x100000030
  &HWIO_PLL1_STATUS_ADDR=0x100000038
  
  ; PLL6 - MPLL2
  &HWIO_PLL2_MODE_ADDR=0x100000040
  &HWIO_PLL2_L_VAL_ADDR=0x100000048
  &HWIO_PLL2_ALPHA_VAL_L_ADDR=0x100000050
  &HWIO_PLL2_ALPHA_VAL_H_ADDR=0x100000058
  &HWIO_PLL2_USER_CTL_ADDR=0x100000060
  &HWIO_PLL2_CONFIG_CTL_ADDR=0x100000068
  &HWIO_PLL2_TEST_CTL_ADDR=0x100000070
  &HWIO_PLL2_STATUS_ADDR=0x100000078
  
  ; PLL7 - MPLL3
  &HWIO_MSS_QDSP6SS_PLL_MODE_ADDR=0xFC880200
  &HWIO_MSS_QDSP6SS_PLL_L_VAL_ADDR=0xFC880204
  &HWIO_MSS_QDSP6SS_PLL_ALPHA_VAL_ADDR=0xFC880208
  &HWIO_MSS_QDSP6SS_PLL_ALPHA_U_VAL_ADDR=0xFC88020C
  &HWIO_MSS_QDSP6SS_PLL_USER_CTL_ADDR=0xFC880210
  &HWIO_MSS_QDSP6SS_PLL_USER_CTL_U_ADDR=0xFC880214
  &HWIO_MSS_QDSP6SS_PLL_CONFIG_CTL_ADDR=0xFC880218
  &HWIO_MSS_QDSP6SS_PLL_TEST_CTL_ADDR=0xFC88021C
  &HWIO_MSS_QDSP6SS_PLL_TEST_CTL_U_ADDR=0xFC880220
  &HWIO_MSS_QDSP6SS_PLL_STATUS_ADDR=0xFC880224
  
  ; PLL8 - MPLL4
  &HWIO_NAV_PLL4_PLLMODE_ADDR=0xFCAF8800
  &HWIO_NAV_PLL4_L_VAL_ADDR=0xFCAF8804
  &HWIO_NAV_PLL4_ALPHA_VAL_L_ADDR=0xFCAF8808
  &HWIO_NAV_PLL4_ALPHA_VAL_H_ADDR=0xFCAF880C
  &HWIO_NAV_PLL4_USER_CTL_ADDR=0xFCAF8810
  &HWIO_NAV_PLL4_USER_CTL_H_ADDR=0xFCAF8814
  &HWIO_NAV_PLL4_CONFIG_CTL_ADDR=0xFCAF8818
  &HWIO_NAV_PLL4_TEST_CTL_ADDR=0xFCAF881C
  &HWIO_NAV_PLL4_STATUS_ADDR=0xFCAF8824
  
  ; PLL9 - LPAPLL0
  &HWIO_LPASS_LPAAUDIO_MODE_ADDR=0xFE000000
  &HWIO_LPASS_LPAAUDIO_L_VAL_ADDR=0xFE000004
  &HWIO_LPASS_LPAAUDIO_ALPHA_VAL_ADDR=0xFE000008
  &HWIO_LPASS_LPAAUDIO_ALPHA_U_VAL_ADDR=0xFE00000C
  &HWIO_LPASS_LPAAUDIO_USER_CTL_ADDR=0xFE000010
  &HWIO_LPASS_LPAAUDIO_USER_CTL_U_ADDR=0xFE000014
  &HWIO_LPASS_LPAAUDIO_CONFIG_CTL_ADDR=0xFE000018
  &HWIO_LPASS_LPAAUDIO_TEST_CTL_ADDR=0xFE00001C
  &HWIO_LPASS_LPAAUDIO_TEST_CTL_U_ADDR=0xFE000020
  &HWIO_LPASS_LPAAUDIO_STATUS_ADDR=0xFE000024
  
  ; PLL10 - LPAPLL1
  &HWIO_LPASS_QDSP6SS_PLL_MODE_ADDR=0xFE200200
  &HWIO_LPASS_QDSP6SS_PLL_L_VAL_ADDR=0xFE200204
  &HWIO_LPASS_QDSP6SS_PLL_ALPHA_VAL_ADDR=0xFE200208
  &HWIO_LPASS_QDSP6SS_PLL_ALPHA_U_VAL_ADDR=0xFE20020C
  &HWIO_LPASS_QDSP6SS_PLL_USER_CTL_ADDR=0xFE200210
  &HWIO_LPASS_QDSP6SS_PLL_USER_CTL_U_ADDR=0xFE200214
  &HWIO_LPASS_QDSP6SS_PLL_CONFIG_CTL_ADDR=0xFE200218
  &HWIO_LPASS_QDSP6SS_PLL_TEST_CTL_ADDR=0xFE20021C
  &HWIO_LPASS_QDSP6SS_PLL_TEST_CTL_U_ADDR=0xFE200220
  &HWIO_LPASS_QDSP6SS_PLL_STATUS_ADDR=0xFE200224
  
  ; PLL11 - LPAPLL2
  &HWIO_LPASS_LPAAUDIO_PRIUS_PLL_MODE_ADDR=0xFE001000
  &HWIO_LPASS_LPAAUDIO_PRIUS_PLL_L_VAL_ADDR=0xFE001004
  &HWIO_LPASS_LPAAUDIO_PRIUS_PLL_ALPHA_VAL_ADDR=0xFE001008
  &HWIO_LPASS_LPAAUDIO_PRIUS_PLL_ALPHA_U_VAL_ADDR=0xFE00100C
  &HWIO_LPASS_LPAAUDIO_PRIUS_PLL_USER_CTL_ADDR=0xFE001010
  &HWIO_LPASS_LPAAUDIO_PRIUS_PLL_USER_CTL_U_ADDR=0xFE001014
  &HWIO_LPASS_LPAAUDIO_PRIUS_PLL_CONFIG_CTL_ADDR=0xFE001018
  &HWIO_LPASS_LPAAUDIO_PRIUS_PLL_TEST_CTL_ADDR=0xFE00101C
  &HWIO_LPASS_LPAAUDIO_PRIUS_PLL_TEST_CTL_U_ADDR=0xFE001020
  &HWIO_LPASS_LPAAUDIO_PRIUS_PLL_STATUS_ADDR=0xFE001024
  
  ; PLL12 - A7PLL0
  &HWIO_APCS_CPU_PLL_MODE_ADDR=0xF9008018
  &HWIO_APCS_CPU_PLL_L_VAL_ADDR=0xF900801C
  &HWIO_APCS_CPU_PLL_ALPHA_VAL_ADDR=0xF9008020
  &HWIO_APCS_CPU_PLL_ALPHA_U_VAL_ADDR=0xF9008024
  &HWIO_APCS_CPU_PLL_USER_CTL_ADDR=0xF9008028
  &HWIO_APCS_CPU_PLL_USER_CTL_U_ADDR=0xF900802C
  &HWIO_APCS_CPU_PLL_CONFIG_CTL_ADDR=0xF9008030
  &HWIO_APCS_CPU_PLL_TEST_CTL_ADDR=0xF9008034
  &HWIO_APCS_CPU_PLL_TEST_CTL_U_ADDR=0xF9008038
  &HWIO_APCS_CPU_PLL_STATUS_ADDR=0xF900803C
  
  goto Init_Constants_Done
  
Format_Dump_Registers:

  ENTRY &num &use &mode_reg &user_ctl_reg &user_ctl_u_reg &config_ctl_reg &test_ctl_reg &test_ctl_u_reg &status_reg
  
  local &mode_val
  local &user_ctl_val
  local &user_ctl_u_val
  local &config_ctl_val
  local &test_ctl_val
  local &test_ctl_u_val
  local &status_val
  local &left_width
  local &temp_string
  local &temp_string_formatted
  
  ; Format PLL num and use
  &num=FORMAT.DECIMAL(0x2, &num)
  
  ; Format mode
  &mode_val=FORMAT.HEX(0x8, data.long(a:&mode_reg))
  &mode_reg=FORMAT.HEX(0x9, &mode_reg)
  
  ; Format user_ctl
  &user_ctl_val=FORMAT.HEX(0x8, data.long(a:&user_ctl_reg))
  &user_ctl_reg=FORMAT.HEX(0x9, &user_ctl_reg)
  
  ; Format user_ctl_u
  &user_ctl_u_val=FORMAT.HEX(0x8, data.long(a:&user_ctl_u_reg))
  &user_ctl_u_reg=FORMAT.HEX(0x9, &user_ctl_u_reg)
  
  ; Format config_ctl
  &config_ctl_val=FORMAT.HEX(0x8, data.long(a:&config_ctl_reg))
  &config_ctl_reg=FORMAT.HEX(0x9, &config_ctl_reg)
  
  ; Format test_ctl
  &test_ctl_val=FORMAT.HEX(0x8, data.long(a:&test_ctl_reg))
  &test_ctl_reg=FORMAT.HEX(0x9, &test_ctl_reg)

  ; Format test_ctl_u
  &test_ctl_u_val=FORMAT.HEX(0x8, data.long(a:&test_ctl_u_reg))
  &test_ctl_u_reg=FORMAT.HEX(0x9, &test_ctl_u_reg)

  ; Format status
  &status_val=FORMAT.HEX(0x8, data.long(a:&status_reg))
  &status_reg=FORMAT.HEX(0x9, &status_reg)
  
  &left_width="                 "
  
  print "______________________________________________"
  &temp_string="[PLL&num : &use]"
  &temp_string_formatted=STRING.CUT("&left_width", STRING.LEN("&temp_string"))
  &temp_string_formatted="&temp_string&temp_string_formatted"
  print "&temp_string_formatted | |     Address : Value"
  
  &temp_string="MODE"
  &temp_string_formatted=STRING.CUT("&left_width", STRING.LEN("&temp_string"))
  &temp_string_formatted="&temp_string_formatted&temp_string"
  print "&temp_string_formatted | | 0x&mode_reg : 0x&mode_val"
  
  &temp_string="USER_CTL"
  &temp_string_formatted=STRING.CUT("&left_width", STRING.LEN("&temp_string"))
  &temp_string_formatted="&temp_string_formatted&temp_string"
  print "&temp_string_formatted | | 0x&user_ctl_reg : 0x&user_ctl_val"
  
  &temp_string="USER_CTL_U"
  &temp_string_formatted=STRING.CUT("&left_width", STRING.LEN("&temp_string"))
  &temp_string_formatted="&temp_string_formatted&temp_string"
  print "&temp_string_formatted | | 0x&user_ctl_u_reg : 0x&user_ctl_u_val"
  
  &temp_string="CONFIG_CTL"
  &temp_string_formatted=STRING.CUT("&left_width", STRING.LEN("&temp_string"))
  &temp_string_formatted="&temp_string_formatted&temp_string"
  print "&temp_string_formatted | | 0x&config_ctl_reg : 0x&config_ctl_val"
  
  &temp_string="TEST_CTL"
  &temp_string_formatted=STRING.CUT("&left_width", STRING.LEN("&temp_string"))
  &temp_string_formatted="&temp_string_formatted&temp_string"
  print "&temp_string_formatted | | 0x&test_ctl_reg : 0x&test_ctl_val"
  
  &temp_string="TEST_CTL_U"
  &temp_string_formatted=STRING.CUT("&left_width", STRING.LEN("&temp_string"))
  &temp_string_formatted="&temp_string_formatted&temp_string"
  print "&temp_string_formatted | | 0x&test_ctl_u_reg : 0x&test_ctl_u_val"
  
  &temp_string="STATUS"
  &temp_string_formatted=STRING.CUT("&left_width", STRING.LEN("&temp_string"))
  &temp_string_formatted="&temp_string_formatted&temp_string"
  print "&temp_string_formatted | | 0x&status_reg : 0x&status_val"
 
  return
  

;-----------------------------------------------------------------------------
; Display the dump of mode/status registers.
;-----------------------------------------------------------------------------

Display_Dump:

  local &mode_reg
  local &user_ctl_reg
  local &user_ctl_u_reg
  local &config_ctl_reg
  local &test_ctl_reg
  local &test_ctl_u_reg
  local &status_reg
  
  ; Display the PLL mode and status registers.
  
  ; PLL0 - GPLL0
  &mode_reg=&HWIO_GCC_GPLL0_MODE_ADDR
  &user_ctl_reg=&HWIO_GCC_GPLL0_USER_CTL_ADDR
  &user_ctl_u_reg=&HWIO_GCC_GPLL0_USER_CTL_U_ADDR
  &config_ctl_reg=&HWIO_GCC_GPLL0_CONFIG_CTL_ADDR
  &test_ctl_reg=&HWIO_GCC_GPLL0_TEST_CTL_ADDR
  &test_ctl_u_reg=&HWIO_GCC_GPLL0_TEST_CTL_U_ADDR
  &status_reg=&HWIO_GCC_GPLL0_STATUS_ADDR
  gosub Format_Dump_Registers 0. GPLL0 &mode_reg &user_ctl_reg &user_ctl_u_reg &config_ctl_reg &test_ctl_reg &test_ctl_u_reg &status_reg

  ; PLL1 - GPLL1
  &mode_reg=&HWIO_GCC_GPLL1_MODE_ADDR
  &user_ctl_reg=&HWIO_GCC_GPLL1_USER_CTL_ADDR
  &user_ctl_u_reg=&HWIO_GCC_GPLL1_USER_CTL_U_ADDR
  &config_ctl_reg=&HWIO_GCC_GPLL1_CONFIG_CTL_ADDR
  &test_ctl_reg=&HWIO_GCC_GPLL1_TEST_CTL_ADDR
  &test_ctl_u_reg=&HWIO_GCC_GPLL1_TEST_CTL_U_ADDR
  &status_reg=&HWIO_GCC_GPLL1_STATUS_ADDR
  gosub Format_Dump_Registers 1. GPLL1 &mode_reg &user_ctl_reg &user_ctl_u_reg &config_ctl_reg &test_ctl_reg &test_ctl_u_reg &status_reg

  ; PLL2 - GPLL2
  &mode_reg=&HWIO_GCC_GPLL2_MODE_ADDR
  &user_ctl_reg=&HWIO_GCC_GPLL2_USER_CTL_ADDR
  &user_ctl_u_reg=&HWIO_GCC_GPLL2_USER_CTL_U_ADDR
  &config_ctl_reg=&HWIO_GCC_GPLL2_CONFIG_CTL_ADDR
  &test_ctl_reg=&HWIO_GCC_GPLL2_TEST_CTL_ADDR
  &test_ctl_u_reg=&HWIO_GCC_GPLL2_TEST_CTL_U_ADDR
  &status_reg=&HWIO_GCC_GPLL2_STATUS_ADDR
  gosub Format_Dump_Registers 2. GPLL2 &mode_reg &user_ctl_reg &user_ctl_u_reg &config_ctl_reg &test_ctl_reg &test_ctl_u_reg &status_reg

  ; PLL3 - GPLL3
  &mode_reg=&HWIO_GCC_GPLL3_MODE_ADDR
  &user_ctl_reg=&HWIO_GCC_GPLL3_USER_CTL_ADDR
  &user_ctl_u_reg=&HWIO_GCC_GPLL3_USER_CTL_U_ADDR
  &config_ctl_reg=&HWIO_GCC_GPLL3_CONFIG_CTL_ADDR
  &test_ctl_reg=&HWIO_GCC_GPLL3_TEST_CTL_ADDR
  &test_ctl_u_reg=&HWIO_GCC_GPLL3_TEST_CTL_U_ADDR
  &status_reg=&HWIO_GCC_GPLL3_STATUS_ADDR
  gosub Format_Dump_Registers 3. GPLL3 &mode_reg &user_ctl_reg &user_ctl_u_reg &config_ctl_reg &test_ctl_reg &test_ctl_u_reg &status_reg

if (&is_mpss==1)
(
  ; PLL4 - MPLL0
  &mode_reg=&HWIO_MSS_OFFLINE_PLL_MODE_ADDR
  &user_ctl_reg=&HWIO_MSS_OFFLINE_PLL_USER_CTL_ADDR
  &user_ctl_u_reg=&HWIO_MSS_OFFLINE_PLL_USER_CTL_U_ADDR
  &config_ctl_reg=&HWIO_MSS_OFFLINE_PLL_CONFIG_CTL_ADDR
  &test_ctl_reg=&HWIO_MSS_OFFLINE_PLL_TEST_CTL_ADDR
  &test_ctl_u_reg=&HWIO_MSS_OFFLINE_PLL_TEST_CTL_U_ADDR
  &status_reg=&HWIO_MSS_OFFLINE_PLL_STATUS_ADDR
  gosub Format_Dump_Registers 4. MPLL0 &mode_reg &user_ctl_reg &user_ctl_u_reg &config_ctl_reg &test_ctl_reg &test_ctl_u_reg &status_reg
  
  ; PLL5 - MPLL1
  &mode_reg=&HWIO_PLL1_MODE_ADDR
  &user_ctl_reg=&HWIO_PLL1_USER_CTL_ADDR
  &user_ctl_u_reg=0
  &config_ctl_reg=&HWIO_PLL1_CONFIG_CTL_ADDR
  &test_ctl_reg=&HWIO_PLL1_TEST_CTL_ADDR
  &test_ctl_u_reg=0
  &status_reg=&HWIO_PLL1_STATUS_ADDR
  gosub Format_Dump_Registers 5. MPLL1 &mode_reg &user_ctl_reg &user_ctl_u_reg &config_ctl_reg &test_ctl_reg &test_ctl_u_reg &status_reg
  
  ; PLL6 - MPLL2
  &mode_reg=&HWIO_PLL2_MODE_ADDR
  &user_ctl_reg=&HWIO_PLL2_USER_CTL_ADDR
  &user_ctl_u_reg=0
  &config_ctl_reg=&HWIO_PLL2_CONFIG_CTL_ADDR
  &test_ctl_reg=&HWIO_PLL2_TEST_CTL_ADDR
  &test_ctl_u_reg=0
  &status_reg=&HWIO_PLL2_STATUS_ADDR
  gosub Format_Dump_Registers 6. MPLL2 &mode_reg &user_ctl_reg &user_ctl_u_reg &config_ctl_reg &test_ctl_reg &test_ctl_u_reg &status_reg
  
  ; PLL7 - MPLL3
  &mode_reg=&HWIO_MSS_QDSP6SS_PLL_MODE_ADDR
  &user_ctl_reg=&HWIO_MSS_QDSP6SS_PLL_USER_CTL_ADDR
  &user_ctl_u_reg=&HWIO_MSS_QDSP6SS_PLL_USER_CTL_U_ADDR
  &config_ctl_reg=&HWIO_MSS_QDSP6SS_PLL_CONFIG_CTL_ADDR
  &test_ctl_reg=&HWIO_MSS_QDSP6SS_PLL_TEST_CTL_ADDR
  &test_ctl_u_reg=&HWIO_MSS_QDSP6SS_PLL_TEST_CTL_U_ADDR
  &status_reg=&HWIO_MSS_QDSP6SS_PLL_STATUS_ADDR
  gosub Format_Dump_Registers 7. MPLL3 &mode_reg &user_ctl_reg &user_ctl_u_reg &config_ctl_reg &test_ctl_reg &test_ctl_u_reg &status_reg
  
  ; PLL8 - MPLL4
  &mode_reg=&HWIO_NAV_PLL4_PLLMODE_ADDR
  &user_ctl_reg=&HWIO_NAV_PLL4_USER_CTL_ADDR
  &user_ctl_u_reg=&HWIO_NAV_PLL4_USER_CTL_H_ADDR
  &config_ctl_reg=&HWIO_NAV_PLL4_CONFIG_CTL_ADDR
  &test_ctl_reg=&HWIO_NAV_PLL4_TEST_CTL_ADDR
  &test_ctl_u_reg=0
  &status_reg=&HWIO_NAV_PLL4_STATUS_ADDR
  gosub Format_Dump_Registers 8. MPLL4 &mode_reg &user_ctl_reg &user_ctl_u_reg &config_ctl_reg &test_ctl_reg &test_ctl_u_reg &status_reg
)

  ; PLL9 - LPAPLL0
  &mode_reg=&HWIO_LPASS_LPAAUDIO_MODE_ADDR
  &user_ctl_reg=&HWIO_LPASS_LPAAUDIO_USER_CTL_ADDR
  &user_ctl_u_reg=&HWIO_LPASS_LPAAUDIO_USER_CTL_U_ADDR
  &config_ctl_reg=&HWIO_LPASS_LPAAUDIO_CONFIG_CTL_ADDR
  &test_ctl_reg=&HWIO_LPASS_LPAAUDIO_TEST_CTL_ADDR
  &test_ctl_u_reg=&HWIO_LPASS_LPAAUDIO_TEST_CTL_U_ADDR
  &status_reg=&HWIO_LPASS_LPAAUDIO_STATUS_ADDR
  gosub Format_Dump_Registers 9. LPAPLL0 &mode_reg &user_ctl_reg &user_ctl_u_reg &config_ctl_reg &test_ctl_reg &test_ctl_u_reg &status_reg
  
  ; PLL10 - LPAPLL1
  &mode_reg=&HWIO_LPASS_QDSP6SS_PLL_MODE_ADDR
  &user_ctl_reg=&HWIO_LPASS_QDSP6SS_PLL_USER_CTL_ADDR
  &user_ctl_u_reg=&HWIO_LPASS_QDSP6SS_PLL_USER_CTL_U_ADDR
  &config_ctl_reg=&HWIO_LPASS_QDSP6SS_PLL_CONFIG_CTL_ADDR
  &test_ctl_reg=&HWIO_LPASS_QDSP6SS_PLL_TEST_CTL_ADDR
  &test_ctl_u_reg=&HWIO_LPASS_QDSP6SS_PLL_TEST_CTL_U_ADDR
  &status_reg=&HWIO_LPASS_QDSP6SS_PLL_STATUS_ADDR
  gosub Format_Dump_Registers 10. LPAPLL1 &mode_reg &user_ctl_reg &user_ctl_u_reg &config_ctl_reg &test_ctl_reg &test_ctl_u_reg &status_reg
  
  ; PLL11 - LPAPLL2
  &mode_reg=&HWIO_LPASS_LPAAUDIO_PRIUS_PLL_MODE_ADDR
  &user_ctl_reg=&HWIO_LPASS_LPAAUDIO_PRIUS_PLL_USER_CTL_ADDR
  &user_ctl_u_reg=&HWIO_LPASS_LPAAUDIO_PRIUS_PLL_USER_CTL_U_ADDR
  &config_ctl_reg=&HWIO_LPASS_LPAAUDIO_PRIUS_PLL_CONFIG_CTL_ADDR
  &test_ctl_reg=&HWIO_LPASS_LPAAUDIO_PRIUS_PLL_TEST_CTL_ADDR
  &test_ctl_u_reg=&HWIO_LPASS_LPAAUDIO_PRIUS_PLL_TEST_CTL_U_ADDR
  &status_reg=&HWIO_LPASS_LPAAUDIO_PRIUS_PLL_STATUS_ADDR
  gosub Format_Dump_Registers 11. LPAPLL2 &mode_reg &user_ctl_reg &user_ctl_u_reg &config_ctl_reg &test_ctl_reg &test_ctl_u_reg &status_reg
  
  ; PLL12 - A7PLL0
  &mode_reg=&HWIO_APCS_CPU_PLL_MODE_ADDR
  &user_ctl_reg=&HWIO_APCS_CPU_PLL_USER_CTL_ADDR
  &user_ctl_u_reg=&HWIO_APCS_CPU_PLL_USER_CTL_U_ADDR
  &config_ctl_reg=&HWIO_APCS_CPU_PLL_CONFIG_CTL_ADDR
  &test_ctl_reg=&HWIO_APCS_CPU_PLL_TEST_CTL_ADDR
  &test_ctl_u_reg=&HWIO_APCS_CPU_PLL_TEST_CTL_U_ADDR
  &status_reg=&HWIO_APCS_CPU_PLL_STATUS_ADDR
  gosub Format_Dump_Registers 12. A7PLL0 &mode_reg &user_ctl_reg &user_ctl_u_reg &config_ctl_reg &test_ctl_reg &test_ctl_u_reg &status_reg
  
  print "" 
  print "" 
  
  return
  

;-----------------------------------------------------------------------------
; Display the PLL setting
;-----------------------------------------------------------------------------

Display_PLL:

  ENTRY &pll_num &pll_name &mode_reg &l_reg &alpha_reg &alpha_u_reg &user_ctl_reg &status_reg
  
  local &mode_val
  local &l_val
  local &alpha_val
  local &alpha_u_val
  local &user_ctl_val
  local &status_val
  local &pll_state
  local &pll_votable
  local &pll_main
  local &pll_test
  local &pll_aux
  local &pll_aux2
  local &pll_early
  local &clk_ref
  local &pll_freq
  local &alpha_combined_hex
  local &alpha_divisor
  local &alpha_float
  local &pll_num_formatted
  local &pll_name_formatted
  
  &mode_val=data.long(a:&mode_reg)
  &l_val=data.long(a:&l_reg)&(&HWIO_PLL_L_VAL_MASK)
  &alpha_val=data.long(a:&alpha_reg)&(&HWIO_PLL_ALPHA_VAL_MASK)
  &alpha_u_val=data.long(a:&alpha_u_reg)&(&HWIO_PLL_ALPHA_U_VAL_MASK)
  &status_val=data.long(a:&status_reg)
  &user_ctl_val=data.long(a:&user_ctl_reg)
  
  ; Check for ON/OFF status
  if (&mode_val&0x80000000)==0x80000000
    &pll_state="ON "
  else
    &pll_state="OFF"

  ; Check for FSM mode
  if (&mode_val&0x100000)==0x100000
    &pll_votable="YES"
  else
    &pll_votable="NO "
    
  ; Check for pre-div
  if (&user_ctl_val&0x7000)==0x1000
    &pre_div=2
  else
    &pre_div=1

  ; Check for post-div
  if (&user_ctl_val&0xF00)==0x100
    &post_div=2
  else if (&user_ctl_val&0xF00)==0x300
    &post_div=4
  else if (&user_ctl_val&0xF00)==0x700
    &post_div=8
  else if (&user_ctl_val&0xF00)==0xF00
    &post_div=16
  else
    &post_div=1

  ; Check for test output
  if (&user_ctl_val&0x10)==0x10
    &pll_test="ON "
  else
    &pll_test="OFF"

  ; Check for early output
  if (&user_ctl_val&0x08)==0x08
    &pll_early="ON "
  else
    &pll_early="OFF"

  ; Check for aux2 output
  if (&user_ctl_val&0x04)==0x04
    &pll_aux2="ON "
  else
    &pll_aux2="OFF"
   
  ; Check for aux output
  if (&user_ctl_val&0x02)==0x02
    &pll_aux="ON "
  else
    &pll_aux="OFF"

  ; Check for main output
  if (&user_ctl_val&0x01)==0x01
    &pll_main="ON "
  else
    &pll_main="OFF"

  &clk_ref=19.2
  
  ; Combine alpha lower + upper
  &alpha_combined_hex=&alpha_val+(&alpha_u_val<<32.)
  &alpha_float=(&alpha_combined_hex*1.0)/((1<<40.)*1.0)
  
  ; Calculate the PLL frequency
  &pll_freq=FORMAT.FLOAT(10, 6, (&clk_ref/&pre_div)*((&l_val+&alpha_float)/&post_div))
  
  ; Format the pll num and name strings
  &pll_num_formatted=FORMAT.DECIMAL(2., &pll_num)
  
  &pll_name_formatted=STRING.CUT("        ", STRING.LEN("&pll_name"))
  &pll_name_formatted="&pll_name&pll_name_formatted"
  
  print "&pll_num_formatted  &pll_name_formatted    &pll_state        &pll_votable        &pll_main        &pll_test        &pll_aux        &pll_aux2        &pll_early  &pll_freq"

  return


;-----------------------------------------------------------------------
; Display Configurations
;-----------------------------------------------------------------------

Display_Configurations:

  local &pll
  local &mode_reg
  local &l_reg
  local &alpha_reg
  local &alpha_u_reg
  local &status_reg

  print "PLL   USE      STATE     VOTABLE   MAIN_OUT   TEST_OUT    AUX_OUT   AUX2_OUT   EARLY_OUT   CALC FREQ (MHz)"
  print "--- --------   -----     -------   --------   --------    -------   --------   ---------   ---------------"

  &pll="GPLL0"
  &mode_reg=&HWIO_GCC_GPLL0_MODE_ADDR
  &l_reg=&HWIO_GCC_GPLL0_L_VAL_ADDR
  &alpha_reg=&HWIO_GCC_GPLL0_ALPHA_VAL_ADDR
  &alpha_u_reg=&HWIO_GCC_GPLL0_ALPHA_U_VAL_ADDR
  &user_ctl_reg=&HWIO_GCC_GPLL0_USER_CTL_ADDR
  &status_reg=&HWIO_GCC_GPLL0_STATUS_ADDR
  gosub Display_PLL 0. &pll &mode_reg &l_reg &alpha_reg &alpha_u_reg &user_ctl_reg &status_reg 

  &pll="GPLL1"
  &mode_reg=&HWIO_GCC_GPLL1_MODE_ADDR
  &l_reg=&HWIO_GCC_GPLL1_L_VAL_ADDR
  &alpha_reg=&HWIO_GCC_GPLL1_ALPHA_VAL_ADDR
  &alpha_u_reg=&HWIO_GCC_GPLL1_ALPHA_U_VAL_ADDR
  &user_ctl_reg=&HWIO_GCC_GPLL1_USER_CTL_ADDR
  &status_reg=&HWIO_GCC_GPLL1_STATUS_ADDR
  gosub Display_PLL 1. &pll &mode_reg &l_reg &alpha_reg &alpha_u_reg &user_ctl_reg &status_reg 
  
  &pll="GPLL2"
  &mode_reg=&HWIO_GCC_GPLL2_MODE_ADDR
  &l_reg=&HWIO_GCC_GPLL2_L_VAL_ADDR
  &alpha_reg=&HWIO_GCC_GPLL2_ALPHA_VAL_ADDR
  &alpha_u_reg=&HWIO_GCC_GPLL2_ALPHA_U_VAL_ADDR
  &user_ctl_reg=&HWIO_GCC_GPLL2_USER_CTL_ADDR
  &status_reg=&HWIO_GCC_GPLL2_STATUS_ADDR
  gosub Display_PLL 2. &pll &mode_reg &l_reg &alpha_reg &alpha_u_reg &user_ctl_reg &status_reg 
  
  &pll="GPLL3"
  &mode_reg=&HWIO_GCC_GPLL3_MODE_ADDR
  &l_reg=&HWIO_GCC_GPLL3_L_VAL_ADDR
  &alpha_reg=&HWIO_GCC_GPLL3_ALPHA_VAL_ADDR
  &alpha_u_reg=&HWIO_GCC_GPLL3_ALPHA_U_VAL_ADDR
  &user_ctl_reg=&HWIO_GCC_GPLL3_USER_CTL_ADDR
  &status_reg=&HWIO_GCC_GPLL3_STATUS_ADDR
  gosub Display_PLL 3. &pll &mode_reg &l_reg &alpha_reg &alpha_u_reg &user_ctl_reg &status_reg 
  
if (&is_mpss==1)
(
  &pll="MPLL0"
  &mode_reg=&HWIO_MSS_OFFLINE_PLL_MODE_ADDR
  &l_reg=&HWIO_MSS_OFFLINE_PLL_L_VAL_ADDR
  &alpha_reg=&HWIO_MSS_OFFLINE_PLL_ALPHA_VAL_ADDR
  &alpha_u_reg=&HWIO_MSS_OFFLINE_PLL_ALPHA_U_VAL_ADDR
  &user_ctl_reg=&HWIO_MSS_OFFLINE_PLL_USER_CTL_ADDR
  &status_reg=&HWIO_MSS_OFFLINE_PLL_STATUS_ADDR
  gosub Display_PLL 4. &pll &mode_reg &l_reg &alpha_reg &alpha_u_reg &user_ctl_reg &status_reg 
  
  &pll="MPLL1"
  &mode_reg=&HWIO_PLL1_MODE_ADDR
  &l_reg=&HWIO_PLL1_L_VAL_ADDR
  &alpha_reg=&HWIO_PLL1_ALPHA_VAL_L_ADDR
  &alpha_u_reg=&HWIO_PLL1_ALPHA_VAL_H_ADDR
  &user_ctl_reg=&HWIO_PLL1_USER_CTL_ADDR
  &status_reg=&HWIO_PLL1_STATUS_ADDR
  gosub Display_PLL 5. &pll &mode_reg &l_reg &alpha_reg &alpha_u_reg &user_ctl_reg &status_reg 
  
  &pll="MPLL2"
  &mode_reg=&HWIO_PLL2_MODE_ADDR
  &l_reg=&HWIO_PLL2_L_VAL_ADDR
  &alpha_reg=&HWIO_PLL2_ALPHA_VAL_L_ADDR
  &alpha_u_reg=&HWIO_PLL2_ALPHA_VAL_H_ADDR
  &user_ctl_reg=&HWIO_PLL2_USER_CTL_ADDR
  &status_reg=&HWIO_PLL2_STATUS_ADDR
  gosub Display_PLL 6. &pll &mode_reg &l_reg &alpha_reg &alpha_u_reg &user_ctl_reg &status_reg 
  
  &pll="MPLL3"
  &mode_reg=&HWIO_MSS_QDSP6SS_PLL_MODE_ADDR
  &l_reg=&HWIO_MSS_QDSP6SS_PLL_L_VAL_ADDR
  &alpha_reg=&HWIO_MSS_QDSP6SS_PLL_ALPHA_VAL_ADDR
  &alpha_u_reg=&HWIO_MSS_QDSP6SS_PLL_ALPHA_U_VAL_ADDR
  &user_ctl_reg=&HWIO_MSS_QDSP6SS_PLL_USER_CTL_ADDR
  &status_reg=&HWIO_MSS_QDSP6SS_PLL_STATUS_ADDR
  gosub Display_PLL 7. &pll &mode_reg &l_reg &alpha_reg &alpha_u_reg &user_ctl_reg &status_reg 
  
  &pll="MPLL4"
  &mode_reg=&HWIO_NAV_PLL4_PLLMODE_ADDR
  &l_reg=&HWIO_NAV_PLL4_L_VAL_ADDR
  &alpha_reg=&HWIO_NAV_PLL4_ALPHA_VAL_L_ADDR
  &alpha_u_reg=&HWIO_NAV_PLL4_ALPHA_VAL_H_ADDR
  &user_ctl_reg=&HWIO_NAV_PLL4_USER_CTL_ADDR
  &status_reg=&HWIO_NAV_PLL4_STATUS_ADDR
  gosub Display_PLL 8. &pll &mode_reg &l_reg &alpha_reg &alpha_u_reg &user_ctl_reg &status_reg 
)
  
  &pll="LPAPLL0"
  &mode_reg=&HWIO_LPASS_LPAAUDIO_MODE_ADDR
  &l_reg=&HWIO_LPASS_LPAAUDIO_L_VAL_ADDR
  &alpha_reg=&HWIO_LPASS_LPAAUDIO_ALPHA_VAL_ADDR
  &alpha_u_reg=&HWIO_LPASS_LPAAUDIO_ALPHA_U_VAL_ADDR
  &user_ctl_reg=&HWIO_LPASS_LPAAUDIO_USER_CTL_ADDR
  &status_reg=&HWIO_LPASS_LPAAUDIO_STATUS_ADDR
  gosub Display_PLL 9. &pll &mode_reg &l_reg &alpha_reg &alpha_u_reg &user_ctl_reg &status_reg 
  
  &pll="LPAPLL1"
  &mode_reg=&HWIO_LPASS_QDSP6SS_PLL_MODE_ADDR
  &l_reg=&HWIO_LPASS_QDSP6SS_PLL_L_VAL_ADDR
  &alpha_reg=&HWIO_LPASS_QDSP6SS_PLL_ALPHA_VAL_ADDR
  &alpha_u_reg=&HWIO_LPASS_QDSP6SS_PLL_ALPHA_U_VAL_ADDR
  &user_ctl_reg=&HWIO_LPASS_QDSP6SS_PLL_USER_CTL_ADDR
  &status_reg=&HWIO_LPASS_QDSP6SS_PLL_STATUS_ADDR
  gosub Display_PLL 10. &pll &mode_reg &l_reg &alpha_reg &alpha_u_reg &user_ctl_reg &status_reg 
  
  &pll="LPAPLL2"
  &mode_reg=&HWIO_LPASS_LPAAUDIO_PRIUS_PLL_MODE_ADDR
  &l_reg=&HWIO_LPASS_LPAAUDIO_PRIUS_PLL_L_VAL_ADDR
  &alpha_reg=&HWIO_LPASS_LPAAUDIO_PRIUS_PLL_ALPHA_VAL_ADDR
  &alpha_u_reg=&HWIO_LPASS_LPAAUDIO_PRIUS_PLL_ALPHA_U_VAL_ADDR
  &user_ctl_reg=&HWIO_LPASS_LPAAUDIO_PRIUS_PLL_USER_CTL_ADDR
  &status_reg=&HWIO_LPASS_LPAAUDIO_PRIUS_PLL_STATUS_ADDR
  gosub Display_PLL 11. &pll &mode_reg &l_reg &alpha_reg &alpha_u_reg &user_ctl_reg &status_reg 
  
  &pll="A7PLL0"
  &mode_reg=&HWIO_APCS_CPU_PLL_MODE_ADDR
  &l_reg=&HWIO_APCS_CPU_PLL_L_VAL_ADDR
  &alpha_reg=&HWIO_APCS_CPU_PLL_ALPHA_VAL_ADDR
  &alpha_u_reg=&HWIO_APCS_CPU_PLL_ALPHA_U_VAL_ADDR
  &user_ctl_reg=&HWIO_APCS_CPU_PLL_USER_CTL_ADDR
  &status_reg=&HWIO_APCS_CPU_PLL_STATUS_ADDR
  gosub Display_PLL 12. &pll &mode_reg &l_reg &alpha_reg &alpha_u_reg &user_ctl_reg &status_reg 
  
  print " "
  print " "
  
  return
  
  
;-----------------------------------------------------------------------
; Get votes for LPASS shared PLL's
;-----------------------------------------------------------------------

Get_PLL_Vote_LPASS:
  &temp_reg=data.long(a:&vote_reg)
  
  if (&temp_reg&0x1)==0x1
    &pll4="Y"
  else
    &pll4=" "
    
  return
  

Display_PLL_Vote:

  ENTRY &image &gcc_vote_reg &lpass_vote_reg
  
  local &pll0
  local &pll1
  local &pll2
  local &pll3
  local &pll9
  local &pll10
  local &gcc_vote_val
  local &lpass_vote_val
  local &image_formatted

  ; Get GCC vote val
  if (&gcc_vote_reg!=0.)
    &gcc_vote_val=data.long(a:&gcc_vote_reg)
  else
    &gcc_vote_val=0.
  
  ; Get LPASS vote val
  if (&lpass_vote_reg!=0.)
    &lpass_vote_val=data.long(a:&lpass_vote_reg)
  else
    &lpass_vote_val=0.
  
  ; Check GCC votes 
  if (&gcc_vote_val&0x1)==0x1
    &pll0="Y"
  else
    &pll0=" "

  if (&gcc_vote_val&0x2)==0x2
    &pll1="Y"
  else
    &pll1=" "

  if (&gcc_vote_val&0x4)==0x4
    &pll2="Y"
  else
    &pll2=" "

  if (&gcc_vote_val&0x8)==0x8
    &pll3="Y"
  else
    &pll3=" "
  
  ; Check LPASS votes
  if (&lpass_vote_val&0x1)==0x1
    &pll9="Y"
  else
    &pll9=" "
  
  if (&lpass_vote_val&0x2)==0x2
    &pll10="Y"
  else
    &pll10=" "
  
  ; Format image string
  &image_formatted=STRING.CUT("        ", STRING.LEN("&image"))
  &image_formatted="&image&image_formatted"
  
  print "|\ |  &image_formatted|  |  |  &pll0  |  &pll1  |  &pll2  |  &pll3  |  &pll9  |  &pll10   |"
  print "| \|__________|  | \|_____|_____|_____|_____|_____|______|"
  print "\  |          |__|  |     |     |     |     |     |      |"
  
  return
  
 
Display_Votes:

  local &image

  print " ___________      ______ _____ _____ _____ _____ ______  "
  print "|\          \    |\     \     \     \     \     \      \  "
  print "| \          \   | \  0  \  1  \  2  \  3  \  9  \  10  \ "
  print "|  \__________\  |  \_____\_____\_____\_____\_____\______\"
  print "|  |          |__|  |     |     |     |     |     |      |"
  
  ; Get RPM votes
  &image="RPM"
  gosub Display_PLL_Vote &image &HWIO_GCC_RPM_GPLL_ENA_VOTE_ADDR 0.
  
  ; Get APCS votes
  &image="APCS"
  gosub Display_PLL_Vote &image &HWIO_GCC_APCS_GPLL_ENA_VOTE_ADDR &HWIO_LPASS_LPA_PLL_VOTE_APPS_ADDR

if (&is_q6==0)
(
  ; Get APCS TZ votes
  &image="APCSTZ"
  gosub Display_PLL_Vote &image &HWIO_GCC_APCS_TZ_GPLL_ENA_VOTE_ADDR 0.
)

if (&is_mpss==1)
(
  ; Get MSS votes
  &image="MPSS"
  gosub Display_PLL_Vote &image &HWIO_GCC_MSS_Q6_GPLL_ENA_VOTE_ADDR 0.
)

  ; Get LPASS votes
  &image="LPASS"
  gosub Display_PLL_Vote &image &HWIO_GCC_LPASS_DSP_GPLL_ENA_VOTE_ADDR &HWIO_LPASS_LPA_PLL_VOTE_LPASSQ6_ADDR
  

if (&is_q6==0)
(
  ; Get SHARE votes
  &image="SHARE"
  gosub Display_PLL_Vote &image &HWIO_GCC_SPARE_GPLL_ENA_VOTE_ADDR 0.
)

  print "  \|__________|    \|_____|_____|_____|_____|_____|______|"
  
  print " "
  print " "

  return


