
;============================================================================
;
; *************** THIS SCRIPT WAS AUTOGENERATED - 2/3/2014 *****************
;
; TARGET
;   msm8916
;
; SCRIPT
;   testpll.cmm - SHARED
;
; GENERAL DESCRIPTION
;   This script can be used to lookup PLL config/status/frequency values.
;
; FUNCTIONS
;   N/A
;
; INITIALIZATION AND SEQUENCING REQUIREMENTS
;
;      Copyright (c) 2014 by Qualcomm Technologies, Inc.  All Rights Reserved.
;============================================================================

;-----------------------------------------------------------------------------
; Local variables
;-----------------------------------------------------------------------------
local &subscript
local &clk_ref
local &l_val
local &m_val
local &n_val
local &pre_div
local &post_div
local &pll_test
local &pll_early
local &pll_aux2
local &pll_aux
local &pll_main
local &post_div
local &pre_div
local &pll_clk
local &pll_mode
local &pll_status
local &pll_mode_addr
local &pll_status_addr
local &pll_user_ctl
local &pll_access_mode
local &pll_enable_choice
local &pll_choice
local &pll_type
local &pll_mpll_divx_cbcr
local &vote_reg
local &is_mpss
local &is_q6
local &pll0
local &pll1
local &pll2
local &pll3
local &pll4
local &pll5
local &pll6

;-----------------------------------------------------------------------------
; Initialize constants
;-----------------------------------------------------------------------------

goto Init_Constants
Init_Constants_Done:

;-----------------------------------------------------------------------------
; Parse commandline arguments
;-----------------------------------------------------------------------------

; These arguments are passed in from testclock.cmm to enable a PLL
&testpll_cmd_arg0=""
&testpll_cmd_arg1=""

ENTRY &testpll_cmd_arg0 &testpll_cmd_arg1

if ("&testpll_cmd_arg0"=="on")||("&testpll_cmd_arg0"=="off")
(
  &pll_enable_choice="&testpll_cmd_arg0"
  &pll_choice="&testpll_cmd_arg1"
  
  gosub Enable_Disable_PLL
  
  ; Nothing else to be done
  goto SCRIPT_END
)


;-----------------------------------------------------------------------------
; Define the window
;-----------------------------------------------------------------------------
&subscript=0

ENTRY &subscript

if "&subscript"==""
(
  AREA.RESet
  WINPOS 0. 0. 100% 100%
  AREA.Create CLOCK
  AREA.view CLOCK
)

AREA.Select CLOCK
AREA.Clear CLOCK


;-----------------------------------------------------------------------------
; Error handler
;-----------------------------------------------------------------------------

on ERROR gosub
(
  print "An Error has Occurred"
  
  return
)


print ""
print ""
print "[------------------------------------------------- TEST PLL TOOL -------------------------------------------------]"
print ""


Help:

print "1: Configurations"
print "2: Votes"
print "3: Mode/Status Dump"
print "4: Turn PLLs on/off [beta]"
print ""
print "x: Exit"
print ""


;-----------------------------------------------------------------------------
; Main Menu
;-----------------------------------------------------------------------------

Main_Menu:

print "Enter option (? for help):"
enter &choice
print "&choice"

if "&choice"=="?"
(
  goto Help
)
else if "&choice"=="x"
(
  if "&subscript"==""
  (
    AREA.CLEAR CLOCK
    AREA.RESET
    WINCLEAR
    term.close 
  )
  
  enddo (0==0)
)
else if &choice==1
(
  gosub Display_Configurations
)
else if &choice==2
(
  gosub Display_Votes
)
else if &choice==3
(
  gosub Display_Dump
)
else if &choice==4
(
  gosub Enable_Disable_PLL_Enter
)
else
(
  print "Invalid selection"
)

GOTO Main_Menu


;-----------------------------------------------------------------------------
; Sub-functions
;-----------------------------------------------------------------------------

Init_Constants:

  &is_mpss=0
  &is_q6=0

  &HWIO_PLL_L_VAL_MASK=0xFF
  &HWIO_PLL_M_VAL_MASK=0x7FFFF
  &HWIO_PLL_N_VAL_MASK=0x7FFFF

  ; GCC PLL Vote Registers
  &HWIO_GCC_RPM_GPLL_ENA_VOTE_ADDR=0x61836000
  &HWIO_GCC_APCS_GPLL_ENA_VOTE_ADDR=0x61845000
  &HWIO_GCC_APCS_TZ_GPLL_ENA_VOTE_ADDR=0x61813010
  &HWIO_GCC_MSS_Q6_GPLL_ENA_VOTE_ADDR=0x6181b000
  &HWIO_GCC_WCSS_GPLL_ENA_VOTE_ADDR=0x61870000
  &HWIO_GCC_SPARE_GPLL_ENA_VOTE_ADDR=0x61800000

    
  ; MSS MPLL1 OUT EARLY DIVx Registers
  &HWIO_MSS_MPLL1_OUT_EARLY_DIV3_CBCR_ADDR=0x64181100
  &HWIO_MSS_MPLL1_OUT_EARLY_DIV5_CBCR_ADDR=0x64181104

  &HWIO_GCC_GPLL0_MODE_ADDR=0x61821000
  &HWIO_GCC_GPLL0_L_VAL_ADDR=0x61821004
  &HWIO_GCC_GPLL0_M_VAL_ADDR=0x61821008
  &HWIO_GCC_GPLL0_N_VAL_ADDR=0x6182100c
  &HWIO_GCC_GPLL0_USER_CTL_ADDR=0x61821010
  &HWIO_GCC_GPLL0_TEST_CTL_ADDR=0x61821014
  &HWIO_GCC_GPLL0_STATUS_ADDR=0x6182101c

  &HWIO_GCC_GPLL1_MODE_ADDR=0x61820000
  &HWIO_GCC_GPLL1_L_VAL_ADDR=0x61820004
  &HWIO_GCC_GPLL1_M_VAL_ADDR=0x61820008
  &HWIO_GCC_GPLL1_N_VAL_ADDR=0x6182000c
  &HWIO_GCC_GPLL1_USER_CTL_ADDR=0x61820010
  &HWIO_GCC_GPLL1_TEST_CTL_ADDR=0x61820014
  &HWIO_GCC_GPLL1_STATUS_ADDR=0x6182001c

  &HWIO_GCC_GPLL2_MODE_ADDR=0x6184a000
  &HWIO_GCC_GPLL2_L_VAL_ADDR=0x6184a004
  &HWIO_GCC_GPLL2_M_VAL_ADDR=0x6184a008
  &HWIO_GCC_GPLL2_N_VAL_ADDR=0x6184a00c
  &HWIO_GCC_GPLL2_USER_CTL_ADDR=0x6184a010
  &HWIO_GCC_GPLL2_TEST_CTL_ADDR=0x6184a018
  &HWIO_GCC_GPLL2_STATUS_ADDR=0x6184a01c

  &HWIO_GCC_BIMC_PLL_MODE_ADDR=0x61823000
  &HWIO_GCC_BIMC_PLL_L_VAL_ADDR=0x61823004
  &HWIO_GCC_BIMC_PLL_M_VAL_ADDR=0x61823008
  &HWIO_GCC_BIMC_PLL_N_VAL_ADDR=0x6182300c
  &HWIO_GCC_BIMC_PLL_USER_CTL_ADDR=0x61823010
  &HWIO_GCC_BIMC_PLL_TEST_CTL_ADDR=0x61823018
  &HWIO_GCC_BIMC_PLL_STATUS_ADDR=0x6182301c

  &HWIO_WCSS_A_PMU_PLL_MODE_ADDR=0x6a21b1c0
  &HWIO_WCSS_A_PMU_PLL_L_VAL_ADDR=0x6a21b1c4
  &HWIO_WCSS_A_PMU_PLL_M_VAL_ADDR=0x6a21b1c8
  &HWIO_WCSS_A_PMU_PLL_N_VAL_ADDR=0x6a21b1cc
  &HWIO_WCSS_A_PMU_PLL_USER_CTL_ADDR=0x6a21b1d0
  &HWIO_WCSS_A_PMU_PLL_TEST_CTL_ADDR=0x6a21b1d8
  &HWIO_WCSS_A_PMU_PLL_STATUS_ADDR=0x6a21b1dc
  
  &HWIO_MSS_MPLL0_MODE_ADDR=0x64181000
  &HWIO_MSS_MPLL0_L_VAL_ADDR=0x64181004
  &HWIO_MSS_MPLL0_M_VAL_ADDR=0x64181008
  &HWIO_MSS_MPLL0_N_VAL_ADDR=0x6418100c
  &HWIO_MSS_MPLL0_USER_CTL_ADDR=0x64181010
  &HWIO_MSS_MPLL0_TEST_CTL_ADDR=0x64181018
  &HWIO_MSS_MPLL0_STATUS_ADDR=0x6418101c

  &HWIO_MSS_MPLL1_MODE_ADDR=0x64181020
  &HWIO_MSS_MPLL1_L_VAL_ADDR=0x64181024
  &HWIO_MSS_MPLL1_M_VAL_ADDR=0x64181028
  &HWIO_MSS_MPLL1_N_VAL_ADDR=0x6418102c
  &HWIO_MSS_MPLL1_USER_CTL_ADDR=0x64181030
  &HWIO_MSS_MPLL1_TEST_CTL_ADDR=0x64181038
  &HWIO_MSS_MPLL1_STATUS_ADDR=0x6418103c

  &HWIO_MSS_MPLL2_MODE_ADDR=0x64181040
  &HWIO_MSS_MPLL2_L_VAL_ADDR=0x64181044
  &HWIO_MSS_MPLL2_M_VAL_ADDR=0x64181048
  &HWIO_MSS_MPLL2_N_VAL_ADDR=0x6418104c
  &HWIO_MSS_MPLL2_USER_CTL_ADDR=0x64181050
  &HWIO_MSS_MPLL2_CONFIG_CTL_ADDR=0x64181054
  &HWIO_MSS_MPLL2_TEST_CTL_ADDR=0x64181058
  &HWIO_MSS_MPLL2_STATUS_ADDR=0x6418105c

  &HWIO_APCS_SH_PLL_MODE_ADDR=0x6b016000
  &HWIO_APCS_SH_PLL_L_VAL_ADDR=0x6b016004
  &HWIO_APCS_SH_PLL_M_VAL_ADDR=0x6b016008
  &HWIO_APCS_SH_PLL_N_VAL_ADDR=0x6b01600c
  &HWIO_APCS_SH_PLL_USER_CTL_ADDR=0x6b016010
  &HWIO_APCS_SH_PLL_CONFIG_CTL_ADDR=0x6b016014
  &HWIO_APCS_SH_PLL_TEST_CTL_ADDR=0x6b016018
  &HWIO_APCS_SH_PLL_STATUS_ADDR=0x6b01601c
  
  goto Init_Constants_Done
  
Format_Dump_Registers:

  ENTRY &num &use &mode_reg &mode_val &status_reg &status_val &user_ctl_reg &user_ctl_val &test_ctl_reg &test_ctl_val
  
  &num=FORMAT.DECIMAL(0x2, &num)
  &mode_reg=FORMAT.HEX(0x8, &mode_reg)
  &mode_val=FORMAT.HEX(0x8, &mode_val)
  &status_reg=FORMAT.HEX(0x8, &status_reg)
  &status_val=FORMAT.HEX(0x8, &status_val)
  &user_ctl_reg=FORMAT.HEX(0x8, &user_ctl_reg)
  &user_ctl_val=FORMAT.HEX(0x8, &user_ctl_val)
  &test_ctl_reg=FORMAT.HEX(0x8, &test_ctl_reg)
  &test_ctl_val=FORMAT.HEX(0x8, &test_ctl_val)

  print "&num" "  " &use "  | 0x&mode_reg : 0x&mode_val |    | 0x&status_reg : 0x&status_val |    | 0x&user_ctl_reg : 0x&user_ctl_val |    | 0x&test_ctl_reg : 0x&test_ctl_val |"

  return
  

;-----------------------------------------------------------------------------
; Display the dump of mode/status registers.
;-----------------------------------------------------------------------------

Display_Dump:

  ; Display the PLL mode and status registers.
 
  print "                 _________________________      _________________________      _________________________      _________________________  "
  print "                /          MODE           \    /         STATUS          \    /        USER CTL         \    /        TEST CTL         \ "
  print "                |-------------------------|    |-------------------------|    |-------------------------|    |-------------------------| " 
  print "PLL    USE      |    Address : Value      |    |    Address : Value      |    |    Address : Value      |    |    Address : Value      | "

  print "--- ----------  |-------------------------|    |-------------------------|    |-------------------------|    |-------------------------| " 

  &mode_reg=&HWIO_GCC_GPLL0_MODE_ADDR
  &mode_val=data.long(a:&mode_reg)
  &status_reg=&HWIO_GCC_GPLL0_STATUS_ADDR
  &status_val=data.long(a:&status_reg)
  &user_ctl_reg=&HWIO_GCC_GPLL0_USER_CTL_ADDR
  &user_ctl_val=data.long(a:&user_ctl_reg)
  &test_ctl_reg=&HWIO_GCC_GPLL0_TEST_CTL_ADDR
  &test_ctl_val=data.long(a:&test_ctl_reg)
  gosub Format_Dump_Registers 0. "GPLL0     " &mode_reg &mode_val &status_reg &status_val &user_ctl_reg &user_ctl_val &test_ctl_reg &test_ctl_val

  print "--- ----------  |-------------------------|    |-------------------------|    |-------------------------|    |-------------------------|" 
  
  &mode_reg=&HWIO_GCC_GPLL1_MODE_ADDR
  &mode_val=data.long(a:&mode_reg)
  &status_reg=&HWIO_GCC_GPLL1_STATUS_ADDR
  &status_val=data.long(a:&status_reg)
  &user_ctl_reg=&HWIO_GCC_GPLL1_USER_CTL_ADDR
  &user_ctl_val=data.long(a:&user_ctl_reg)
  &test_ctl_reg=&HWIO_GCC_GPLL1_TEST_CTL_ADDR
  &test_ctl_val=data.long(a:&test_ctl_reg)
  gosub Format_Dump_Registers 1. "GPLL1     " &mode_reg &mode_val &status_reg &status_val &user_ctl_reg &user_ctl_val &test_ctl_reg &test_ctl_val

  print "--- ----------  |-------------------------|    |-------------------------|    |-------------------------|    |-------------------------|" 
  
  &mode_reg=&HWIO_GCC_GPLL2_MODE_ADDR
  &mode_val=data.long(a:&mode_reg)
  &status_reg=&HWIO_GCC_GPLL2_STATUS_ADDR
  &status_val=data.long(a:&status_reg)
  &user_ctl_reg=&HWIO_GCC_GPLL2_USER_CTL_ADDR
  &user_ctl_val=data.long(a:&user_ctl_reg)
  &test_ctl_reg=&HWIO_GCC_GPLL2_TEST_CTL_ADDR
  &test_ctl_val=data.long(a:&test_ctl_reg)
  gosub Format_Dump_Registers 2. "GPLL2     " &mode_reg &mode_val &status_reg &status_val &user_ctl_reg &user_ctl_val &test_ctl_reg &test_ctl_val
  
  print "--- ----------  |-------------------------|    |-------------------------|    |-------------------------|    |-------------------------|" 
  
  &mode_reg=&HWIO_GCC_BIMC_PLL_MODE_ADDR
  &mode_val=data.long(a:&mode_reg)
  &status_reg=&HWIO_GCC_BIMC_PLL_STATUS_ADDR
  &status_val=data.long(a:&status_reg)
  &user_ctl_reg=&HWIO_GCC_BIMC_PLL_USER_CTL_ADDR
  &user_ctl_val=data.long(a:&user_ctl_reg)
  &test_ctl_reg=&HWIO_GCC_BIMC_PLL_TEST_CTL_ADDR
  &test_ctl_val=data.long(a:&test_ctl_reg)
  gosub Format_Dump_Registers 3. "BIMCPLL   " &mode_reg &mode_val &status_reg &status_val &user_ctl_reg &user_ctl_val &test_ctl_reg &test_ctl_val
  
  print "--- ----------  |-------------------------|    |-------------------------|    |-------------------------|    |-------------------------|" 
  
  &mode_reg=&HWIO_WCSS_A_PMU_PLL_MODE_ADDR
  &mode_val=data.long(a:&mode_reg)
  &status_reg=&HWIO_WCSS_A_PMU_PLL_STATUS_ADDR
  &status_val=data.long(a:&status_reg)
  &user_ctl_reg=&HWIO_WCSS_A_PMU_PLL_USER_CTL_ADDR
  &user_ctl_val=data.long(a:&user_ctl_reg)
  &test_ctl_reg=&HWIO_WCSS_A_PMU_PLL_TEST_CTL_ADDR
  &test_ctl_val=data.long(a:&test_ctl_reg)
  gosub Format_Dump_Registers 4. "WCNPLL    " &mode_reg &mode_val &status_reg &status_val &user_ctl_reg &user_ctl_val &test_ctl_reg &test_ctl_val
  
  print "--- ----------  |-------------------------|    |-------------------------|    |-------------------------|    |-------------------------|" 

if (&is_mpss==1)
(
  &mode_reg=&HWIO_MSS_MPLL0_MODE_ADDR
  &mode_val=data.long(a:&mode_reg)
  &status_reg=&HWIO_MSS_MPLL0_STATUS_ADDR
  &status_val=data.long(a:&status_reg)
  &user_ctl_reg=&HWIO_MSS_MPLL0_USER_CTL_ADDR
  &user_ctl_val=data.long(a:&user_ctl_reg)
  &test_ctl_reg=&HWIO_MSS_MPLL0_TEST_CTL_ADDR
  &test_ctl_val=data.long(a:&test_ctl_reg)
  gosub Format_Dump_Registers 5. "MPLL0    " &mode_reg &mode_val &status_reg &status_val &user_ctl_reg &user_ctl_val &test_ctl_reg &test_ctl_val
  
  print "--- ----------  |-------------------------|    |-------------------------|    |-------------------------|    |-------------------------|" 
  
  &mode_reg=&HWIO_MSS_MPLL1_MODE_ADDR
  &mode_val=data.long(a:&mode_reg)
  &status_reg=&HWIO_MSS_MPLL1_STATUS_ADDR
  &status_val=data.long(a:&status_reg)
  &user_ctl_reg=&HWIO_MSS_MPLL1_USER_CTL_ADDR
  &user_ctl_val=data.long(a:&user_ctl_reg)
  &test_ctl_reg=&HWIO_MSS_MPLL1_TEST_CTL_ADDR
  &test_ctl_val=data.long(a:&test_ctl_reg)
  gosub Format_Dump_Registers 6. "MPLL1     " &mode_reg &mode_val &status_reg &status_val &user_ctl_reg &user_ctl_val &test_ctl_reg &test_ctl_val
  
  print "--- ----------  |-------------------------|    |-------------------------|    |-------------------------|    |-------------------------|" 
  
  &mode_reg=&HWIO_MSS_MPLL2_MODE_ADDR
  &mode_val=data.long(a:&mode_reg)
  &status_reg=&HWIO_MSS_MPLL2_STATUS_ADDR
  &status_val=data.long(a:&status_reg)
  &user_ctl_reg=&HWIO_MSS_MPLL2_USER_CTL_ADDR
  &user_ctl_val=data.long(a:&user_ctl_reg)
  &test_ctl_reg=&HWIO_MSS_MPLL2_TEST_CTL_ADDR
  &test_ctl_val=data.long(a:&test_ctl_reg)
  gosub Format_Dump_Registers 7. "MPLL2     " &mode_reg &mode_val &status_reg &status_val &user_ctl_reg &user_ctl_val &test_ctl_reg &test_ctl_val
  
  print "--- ----------  |-------------------------|    |-------------------------|    |-------------------------|    |-------------------------|" 
)

  &mode_reg=&HWIO_APCS_SH_PLL_MODE_ADDR
  &mode_val=data.long(a:&mode_reg)
  &status_reg=&HWIO_APCS_SH_PLL_STATUS_ADDR
  &status_val=data.long(a:&status_reg)
  &user_ctl_reg=&HWIO_APCS_SH_PLL_USER_CTL_ADDR
  &user_ctl_val=data.long(a:&user_ctl_reg)
  &test_ctl_reg=&HWIO_APCS_SH_PLL_TEST_CTL_ADDR
  &test_ctl_val=data.long(a:&test_ctl_reg)
  gosub Format_Dump_Registers 8. "A7SSPLL   " &mode_reg &mode_val &status_reg &status_val &user_ctl_reg &user_ctl_val &test_ctl_reg &test_ctl_val
  
  print "--- ----------  |-------------------------|    |-------------------------|    |-------------------------|    |-------------------------|" 

  print "" 
  print "" 

  return

;-----------------------------------------------------------------------------
; Calculate Pre-div and Post-Div for those SR PLLs; where
; Pre div  [14:12]
; Post-Div [9:8]
;-----------------------------------------------------------------------------

Calculate_Pre_Post_Div_SR:

  if (&pll_user_ctl&0x7000)==0x0000
    &pre_div=1
  else if (&pll_user_ctl&0x7000)==0x1000
    &pre_div=2
  else if (&pll_user_ctl&0x7000)==0x2000
    &pre_div=3
  else if (&pll_user_ctl&0x7000)==0x3000
    &pre_div=4
  else if (&pll_user_ctl&0x7000)==0x4000
    &pre_div=5
  else if (&pll_user_ctl&0x7000)==0x5000
    &pre_div=6
  else if (&pll_user_ctl&0x7000)==0x6000
    &pre_div=7
  else
    &pre_div=8

  if (&pll_user_ctl&0x300)==0x000
    &post_div=1
  else if (&pll_user_ctl&0x300)==0x100
    &post_div=2
  else
    &post_div=4

  return


;-----------------------------------------------------------------------------
; Calculate Pre-div and Post-Div for those SR2 PLLs; where
; Pre div  [12]
; Post-Div [9:8]
;-----------------------------------------------------------------------------

Calculate_Pre_Post_Div_SR2:

  if (&pll_user_ctl&0x1000)==0x0000
    &pre_div=1
  else
    &pre_div=2

  if (&pll_user_ctl&0x300)==0x000
    &post_div=1
  else if (&pll_user_ctl&0x300)==0x100
    &post_div=2
  else
    &post_div=4

  return


;-----------------------------------------------------------------------------
; Calculate Pre-div and Post-Div for those HF PLLs; where
; Pre div  [12]
; Post-Div [9:8]
;-----------------------------------------------------------------------------

Calculate_Pre_Post_Div_HF:

  if (&pll_user_ctl&0x1000)==0x0000
    &pre_div=1
  else
    &pre_div=2

  if (&pll_user_ctl&0x300)==0x000
    &post_div=1
  else if (&pll_user_ctl&0x300)==0x100
    &post_div=2
  else
    &post_div=4


  return


;-----------------------------------------------------------------------------
; Calculate Clock
; PLL_REF_XO_SEL[4]
; 0: PXO (27)
; 1: CXO (19.2)
;-----------------------------------------------------------------------------

Calculate_Clk:

  &clk_ref=19.2

  return


;-----------------------------------------------------------------------------
; Calculate Clock_WCSS 
; PLL_REF_XO_SEL[5:4]
; 0: CXO (19.2)
; 1: RF_24MHZ_XO_SRC (24.0)
;-----------------------------------------------------------------------------

Calculate_Clk_WCSS:
  if (&pll_clk&0x30)==0
    &clk_ref=19.2
  else
    &clk_ref=24.0

  return


;-----------------------------------------------------------------------------
; Calculate if MAIN/EARLY/BIST/AUX bit are enable or not
; TEST  [4]
; EARLY [3]
; AUX2  [2]
; AUX   [1]
; MAIN  [0]
;-----------------------------------------------------------------------------

Calculate_MAIN_EARLY_BIST_AUX_ENA:

  if (&pll_user_ctl&0x10)==0x10
    &pll_test="ON "
  else
    &pll_test="OFF"

  if (&pll_user_ctl&0x08)==0x08
    &pll_early="ON "
  else
    &pll_early="OFF"

  if (&pll_user_ctl&0x04)==0x04
    &pll_aux2="ON "
  else
    &pll_aux2="OFF"
   
  if (&pll_user_ctl&0x02)==0x02
    &pll_aux="ON "
  else
    &pll_aux="OFF"

  if (&pll_user_ctl&0x01)==0x01
    &pll_main="ON "
  else
    &pll_main="OFF"

  return


;-----------------------------------------------------------------------------
; Display the PLL setting
;-----------------------------------------------------------------------------

Display_PLL:

  if (&pll_status&0x10000)==0x10000
    &pll_state="ON "
  else
    &pll_state="OFF"

  if (&pll_mode&0x100000)==0x100000
    &pll_votable="YES"
  else
    &pll_votable="NO "

  if &n_val==0
    &n_val=1
    
  &clk_freq=FORMAT.FLOAT(10, 6, (&clk_ref*&l_val+&clk_ref*&m_val/&n_val)/&pre_div/&post_div)
  
  print "&pll    &pll_state        &pll_votable        &pll_main        &pll_test        &pll_aux        &pll_aux2        &pll_early  &clk_freq"

  return


;-----------------------------------------------------------------------
; Display Configurations
;-----------------------------------------------------------------------

Display_Configurations:
  print "PLL    USE       STATE     VOTABLE   MAIN_OUT   TEST_OUT    AUX_OUT   AUX2_OUT   EARLY_OUT   CALC FREQ (MHz)"
  print "--- ----------   -----     -------   --------   --------    -------   --------   ---------   ---------------"

  &pll=" 0  GPLL0     "
  &pll_clk=data.long(a:&HWIO_GCC_GPLL0_MODE_ADDR)
  &pll_mode=data.long(a:&HWIO_GCC_GPLL0_MODE_ADDR)
  &pll_status=data.long(a:&HWIO_GCC_GPLL0_STATUS_ADDR)
  &pll_user_ctl=data.long(a:&HWIO_GCC_GPLL0_USER_CTL_ADDR)
  &l_val=data.long(a:&HWIO_GCC_GPLL0_L_VAL_ADDR)&(&HWIO_PLL_L_VAL_MASK)
  &m_val=data.long(a:&HWIO_GCC_GPLL0_M_VAL_ADDR)&(&HWIO_PLL_M_VAL_MASK)
  &n_val=data.long(a:&HWIO_GCC_GPLL0_N_VAL_ADDR)&(&HWIO_PLL_N_VAL_MASK)
  gosub Calculate_Clk
  gosub Calculate_Pre_Post_Div_SR
  gosub Calculate_MAIN_EARLY_BIST_AUX_ENA
  gosub Display_PLL

  &pll=" 1  GPLL1     "
  &pll_clk=data.long(a:&HWIO_GCC_GPLL1_MODE_ADDR)
  &pll_mode=data.long(a:&HWIO_GCC_GPLL1_MODE_ADDR)
  &pll_status=data.long(a:&HWIO_GCC_GPLL1_STATUS_ADDR)
  &pll_user_ctl=data.long(a:&HWIO_GCC_GPLL1_USER_CTL_ADDR)
  &l_val=data.long(a:&HWIO_GCC_GPLL1_L_VAL_ADDR)&(&HWIO_PLL_L_VAL_MASK)
  &m_val=data.long(a:&HWIO_GCC_GPLL1_M_VAL_ADDR)&(&HWIO_PLL_M_VAL_MASK)
  &n_val=data.long(a:&HWIO_GCC_GPLL1_N_VAL_ADDR)&(&HWIO_PLL_N_VAL_MASK)
  gosub Calculate_Clk
  gosub Calculate_Pre_Post_Div_SR
  gosub Calculate_MAIN_EARLY_BIST_AUX_ENA
  gosub Display_PLL

  &pll=" 2  GPLL2     "
  &pll_clk=data.long(a:&HWIO_GCC_GPLL2_MODE_ADDR)
  &pll_mode=data.long(a:&HWIO_GCC_GPLL2_MODE_ADDR)
  &pll_status=data.long(a:&HWIO_GCC_GPLL2_STATUS_ADDR)
  &pll_user_ctl=data.long(a:&HWIO_GCC_GPLL2_USER_CTL_ADDR)
  &l_val=data.long(a:&HWIO_GCC_GPLL2_L_VAL_ADDR)&(&HWIO_PLL_L_VAL_MASK)
  &m_val=data.long(a:&HWIO_GCC_GPLL2_M_VAL_ADDR)&(&HWIO_PLL_M_VAL_MASK)
  &n_val=data.long(a:&HWIO_GCC_GPLL2_N_VAL_ADDR)&(&HWIO_PLL_N_VAL_MASK)
  gosub Calculate_Clk
  gosub Calculate_Pre_Post_Div_SR
  gosub Calculate_MAIN_EARLY_BIST_AUX_ENA
  gosub Display_PLL
  
  &pll=" 3  BIMCPLL   "
  &pll_clk=data.long(a:&HWIO_GCC_BIMC_PLL_MODE_ADDR)
  &pll_mode=data.long(a:&HWIO_GCC_BIMC_PLL_MODE_ADDR)
  &pll_status=data.long(a:&HWIO_GCC_BIMC_PLL_STATUS_ADDR)
  &pll_user_ctl=data.long(a:&HWIO_GCC_BIMC_PLL_USER_CTL_ADDR)
  &l_val=data.long(a:&HWIO_GCC_BIMC_PLL_L_VAL_ADDR)&(&HWIO_PLL_L_VAL_MASK)
  &m_val=data.long(a:&HWIO_GCC_BIMC_PLL_M_VAL_ADDR)&(&HWIO_PLL_M_VAL_MASK)
  &n_val=data.long(a:&HWIO_GCC_BIMC_PLL_N_VAL_ADDR)&(&HWIO_PLL_N_VAL_MASK)
  gosub Calculate_Clk
  gosub Calculate_Pre_Post_Div_SR
  gosub Calculate_MAIN_EARLY_BIST_AUX_ENA
  gosub Display_PLL
  
  &pll=" 4  WCNPLL    "
  &pll_clk=data.long(a:&HWIO_WCSS_A_PMU_PLL_MODE_ADDR)
  &pll_mode=data.long(a:&HWIO_WCSS_A_PMU_PLL_MODE_ADDR)
  &pll_status=data.long(a:&HWIO_WCSS_A_PMU_PLL_STATUS_ADDR)
  &pll_user_ctl=data.long(a:&HWIO_WCSS_A_PMU_PLL_USER_CTL_ADDR)
  &l_val=data.long(a:&HWIO_WCSS_A_PMU_PLL_L_VAL_ADDR)&(&HWIO_PLL_L_VAL_MASK)
  &m_val=data.long(a:&HWIO_WCSS_A_PMU_PLL_M_VAL_ADDR)&(&HWIO_PLL_M_VAL_MASK)
  &n_val=data.long(a:&HWIO_WCSS_A_PMU_PLL_N_VAL_ADDR)&(&HWIO_PLL_N_VAL_MASK)
  gosub Calculate_Clk_WCSS
  gosub Calculate_Pre_Post_Div_SR2
  gosub Calculate_MAIN_EARLY_BIST_AUX_ENA
  gosub Display_PLL

if (&is_mpss==1)
(
  &pll=" 5   MPLL0    "
  &pll_clk=data.long(a:&HWIO_MSS_MPLL0_MODE_ADDR)
  &pll_mode=data.long(a:&HWIO_MSS_MPLL0_MODE_ADDR)
  &pll_status=data.long(a:&HWIO_MSS_MPLL0_STATUS_ADDR)
  &pll_user_ctl=data.long(a:&HWIO_MSS_MPLL0_USER_CTL_ADDR)
  &l_val=data.long(a:&HWIO_MSS_MPLL0_L_VAL_ADDR)&(&HWIO_PLL_L_VAL_MASK)
  &m_val=data.long(a:&HWIO_MSS_MPLL0_M_VAL_ADDR)&(&HWIO_PLL_M_VAL_MASK)
  &n_val=data.long(a:&HWIO_MSS_MPLL0_N_VAL_ADDR)&(&HWIO_PLL_N_VAL_MASK)
  gosub Calculate_Clk
  gosub Calculate_Pre_Post_Div_SR
  gosub Calculate_MAIN_EARLY_BIST_AUX_ENA
  gosub Display_PLL
  
  &pll=" 6   MPLL1    "
  &pll_clk=data.long(a:&HWIO_MSS_MPLL1_MODE_ADDR)
  &pll_mode=data.long(a:&HWIO_MSS_MPLL1_MODE_ADDR)
  &pll_status=data.long(a:&HWIO_MSS_MPLL1_STATUS_ADDR)
  &pll_user_ctl=data.long(a:&HWIO_MSS_MPLL1_USER_CTL_ADDR)
  &l_val=data.long(a:&HWIO_MSS_MPLL1_L_VAL_ADDR)&(&HWIO_PLL_L_VAL_MASK)
  &m_val=data.long(a:&HWIO_MSS_MPLL1_M_VAL_ADDR)&(&HWIO_PLL_M_VAL_MASK)
  &n_val=data.long(a:&HWIO_MSS_MPLL1_N_VAL_ADDR)&(&HWIO_PLL_N_VAL_MASK)
  gosub Calculate_Clk
  gosub Calculate_Pre_Post_Div_SR2
  gosub Calculate_MAIN_EARLY_BIST_AUX_ENA
  gosub Display_PLL
  
  &pll="7    MPLL2    "
  &pll_clk=data.long(a:&HWIO_MSS_MPLL2_MODE_ADDR)
  &pll_mode=data.long(a:&HWIO_MSS_MPLL2_MODE_ADDR)
  &pll_status=data.long(a:&HWIO_MSS_MPLL2_STATUS_ADDR)
  &pll_user_ctl=data.long(a:&HWIO_MSS_MPLL2_USER_CTL_ADDR)
  &l_val=data.long(a:&HWIO_MSS_MPLL2_L_VAL_ADDR)&(&HWIO_PLL_L_VAL_MASK)
  &m_val=data.long(a:&HWIO_MSS_MPLL2_M_VAL_ADDR)&(&HWIO_PLL_M_VAL_MASK)
  &n_val=data.long(a:&HWIO_MSS_MPLL2_N_VAL_ADDR)&(&HWIO_PLL_N_VAL_MASK)
  gosub Calculate_Clk
  gosub Calculate_Pre_Post_Div_SR
  gosub Calculate_MAIN_EARLY_BIST_AUX_ENA
  gosub Display_PLL
)

  &pll="8  A7SS PLL   " 
  &pll_clk=data.long(a:&HWIO_APCS_SH_PLL_MODE_ADDR)
  &pll_mode=data.long(a:&HWIO_APCS_SH_PLL_MODE_ADDR)
  &pll_status=data.long(a:&HWIO_APCS_SH_PLL_STATUS_ADDR)
  &pll_user_ctl=data.long(a:&HWIO_APCS_SH_PLL_USER_CTL_ADDR)
  &l_val=data.long(a:&HWIO_APCS_SH_PLL_L_VAL_ADDR)&(&HWIO_PLL_L_VAL_MASK)
  &m_val=data.long(a:&HWIO_APCS_SH_PLL_M_VAL_ADDR)&(&HWIO_PLL_M_VAL_MASK)
  &n_val=data.long(a:&HWIO_APCS_SH_PLL_N_VAL_ADDR)&(&HWIO_PLL_N_VAL_MASK)
  gosub Calculate_Clk
  gosub Calculate_Pre_Post_Div_SR2
  gosub Calculate_MAIN_EARLY_BIST_AUX_ENA
  gosub Display_PLL
  
  print " "
  print " "

  return


;-----------------------------------------------------------------------
; Enable or Disable a PLL - Wrapper
;-----------------------------------------------------------------------

Enable_Disable_PLL_Enter:

  &pll_choice=""
  gosub Enable_Disable_PLL

  return


;-----------------------------------------------------------------------
; Enable or Disable a PLL
;-----------------------------------------------------------------------

Enable_Disable_PLL:
  &pll_access_mode="a:"

  print "Warning: PLL must already be configured, or the script will hang while waiting for the PLL to lock."
  print ""

  ; Prompt user to choose PLL if choice not passed in via commandline
  if ("&pll_choice"=="")
  (
    print "Available PLLs are: "
    if (&is_mpss==1)
    (
      print "[GPLL0  GPLL1  GPLL2  BIMCPLL  WCNPLL  MPLL0  MPLL1  MPLL2  A7PLL]"	  
    )
    else
    (
      print "[GPLL0  GPLL1  GPLL2  BIMCPLL  WCNPLL  A7PLL]"
    )
    print ""
    print "Enter PLL: "
    enter &pll_choice
    
    print "Enter on/off: "
    enter &pll_enable_choice
  )

  print "PLL: " "&pll_choice" "."

  ; Handle votable GPLLs
  if ("&pll_choice"=="GPLL0")||("&pll_choice"=="GPLL1")||("&pll_choice"=="GPLL2")||("&pll_choice"=="BIMCPLL")
  (
    ; Set corresponding bit to put a vote in for the PLL
    &access_mode_gcc_vote="a:"

    &pll_sel=0x0

    if ("&pll_choice"=="GPLL0")
    ( 
      &pll_mode_addr=&HWIO_GCC_GPLL0_MODE_ADDR
      &pll_mode=data.long(a:&pll_mode_addr)
      &pll_status_addr=&HWIO_GCC_GPLL0_STATUS_ADDR
      &pll_sel=0x00000001
    )
    else if ("&pll_choice"=="GPLL1")
    ( 
      &pll_mode_addr=&HWIO_GCC_GPLL1_MODE_ADDR
      &pll_mode=data.long(a:&pll_mode_addr)
      &pll_status_addr=&HWIO_GCC_GPLL1_STATUS_ADDR
      &pll_sel=0x00000002
    )
    else if ("&pll_choice"=="GPLL2")
    ( 
      &pll_mode_addr=&HWIO_GCC_GPLL2_MODE_ADDR
      &pll_mode=data.long(a:&pll_mode_addr)
      &pll_status_addr=&HWIO_GCC_GPLL2_STATUS_ADDR
      &pll_sel=0x00000004
    )
    else if ("&pll_choice"=="BIMCPLL")
    ( 
      &pll_mode_addr=&HWIO_GCC_BIMC_PLL_MODE_ADDR
      &pll_mode=data.long(a:&pll_mode_addr)
      &pll_status_addr=&HWIO_GCC_BIMC_PLL_STATUS_ADDR
      &pll_sel=0x00000008
    )

    if (&pll_mode&0x100000)==0x100000
    (
      ; This PLL is votable
      print "This source is votable. Which processor do you want to vote from? Choices are: "
      if (&is_mpss==1)
      (
        print "[rpm  apcs  tz  mss  wcss  spare]"
      )
      else
      (
        print "[rpm  apcs  tz  wcss  spare]"
      )

      print ""
      print "Enter your choice: "
      enter &subsystem

      if ("&subsystem"=="rpm")
      (
        &vote_reg=&HWIO_GCC_RPM_GPLL_ENA_VOTE_ADDR
      )
      else if ("&subsystem"=="apcs")
      (
        &vote_reg=&HWIO_GCC_APCS_GPLL_ENA_VOTE_ADDR
      )
      else if ("&subsystem"=="tz")
      (
        &vote_reg=&HWIO_GCC_APCS_TZ_GPLL_ENA_VOTE_ADDR
      )
      else if ("&subsystem"=="mss")
      (
        &access_mode_gcc_vote="a:"
        &vote_reg=&HWIO_GCC_MSS_Q6_GPLL_ENA_VOTE_ADDR
      )
      else if ("&subsystem"=="wcss")
      (
        &vote_reg=&HWIO_GCC_WCSS_GPLL_ENA_VOTE_ADDR
      )
      else if ("&subsystem"=="spare")
      (
        &vote_reg=&HWIO_GCC_SPARE_GPLL_ENA_VOTE_ADDR
      )
      else
      (
    	print "Invalid selection."
    	print ""
    	goto Enable_Disable_PLL
      )

      if ("&pll_enable_choice"=="on")
      (
        data.set &access_mode_gcc_vote&vote_reg %long (data.long(&access_mode_gcc_vote&vote_reg)|(&pll_sel))
      )
      else
      (
        data.set &access_mode_gcc_vote&vote_reg %long (data.long(&access_mode_gcc_vote&vote_reg)&~(&pll_sel))
      )
    )
	else
	(
      if ("&pll_enable_choice"=="on")
      (
        gosub Generic_PLL_Enable
      )
	  else
	  (
        gosub Generic_PLL_Disable
      )
	)
    print "Turned source " "&pll_enable_choice" "."
    print ""
    return
  )

  ; Handle non-votable PLLs
  &pll_choice_is_valid="no"
  if ("&pll_choice"=="WCNPLL")
  (
    &pll_mode_addr=&HWIO_WCSS_A_PMU_PLL_MODE_ADDR
    &pll_status_addr=&HWIO_WCSS_A_PMU_PLL_STATUS_ADDR
    &pll_type="sr2_pll"
    &pll_choice_is_valid="yes"
  )
if (&is_mpss==1)
(
  &pll_access_mode="a:"
  &pll_mpll_divx_cbcr=0x0

  if ("&pll_choice"=="MPLL0")
  (
    &pll_mode_addr=&HWIO_MSS_MPLL0_MODE_ADDR
    &pll_status_addr=&HWIO_MSS_MPLL0_STATUS_ADDR
    &pll_type="sr_pll"
    &pll_choice_is_valid="yes"
  )
  
  if ("&pll_choice"=="MPLL1")
  (
    &pll_mode_addr=&HWIO_MSS_MPLL1_MODE_ADDR
    &pll_status_addr=&HWIO_MSS_MPLL1_STATUS_ADDR
    &pll_type="sr2_pll"
    &pll_choice_is_valid="yes"
  )
  if ("&pll_choice"=="MPLL2")
  (
    &pll_mode_addr=&HWIO_MSS_MPLL2_MODE_ADDR
    &pll_status_addr=&HWIO_MSS_MPLL2_STATUS_ADDR
    &pll_type="sr_pll"
    &pll_choice_is_valid="yes"
  )
  if ("&pll_choice"=="MPLL1_OUT_EARLY_DIV3")
  (
    &pll_mode_addr=&HWIO_MSS_MPLL1_MODE_ADDR
    &pll_status_addr=&HWIO_MSS_MPLL1_STATUS_ADDR
    &pll_type="sr2_pll"
    &pll_choice_is_valid="yes"
    &pll_mpll_divx_cbcr=&HWIO_MSS_MPLL1_OUT_EARLY_DIV3_CBCR_ADDR
  )
  if ("&pll_choice"=="MPLL1_OUT_EARLY_DIV5")
  (
    &pll_mode_addr=&HWIO_MSS_MPLL1_MODE_ADDR
    &pll_status_addr=&HWIO_MSS_MPLL1_STATUS_ADDR
    &pll_type="sr2_pll"
    &pll_choice_is_valid="yes"
    &pll_mpll_divx_cbcr=&HWIO_MSS_MPLL1_OUT_EARLY_DIV5_CBCR_ADDR
  )
)
  if ("&pll_choice"=="A7PLL")
  (
    &pll_mode_addr=&HWIO_APCS_SH_PLL_MODE_ADDR
    &pll_status_addr=&HWIO_APCS_SH_PLL_STATUS_ADDR
    &pll_type="sr2_pll"
    &pll_choice_is_valid="yes"
  )
  
  if ("&pll_choice_is_valid"=="yes")
  (
    if ("&pll_enable_choice"=="on")
    (
      gosub Generic_PLL_Enable
    )
    else
    (
      gosub Generic_PLL_Disable
    )
    print "Turned source " "&pll_enable_choice" "."
    print ""
  )

  return


;-----------------------------------------------------------------------
; Enable SR / SR2 PLL
;-----------------------------------------------------------------------
				  
Generic_PLL_Enable:

  ; Return if PLL is already locked
  if (data.long(&pll_access_mode&pll_status_addr)&0x10000)==0x10000
  (
    return
  )

  ; Put the PLL in reset
  &mode_val=data.long(&pll_access_mode&pll_mode_addr)
  &mode_val=&mode_val&~(0x00000001|0x00000002|0x00000004)
  data.set &pll_access_mode&pll_mode_addr %long &mode_val

  if ("&pll_type"=="sr_pll")
  (
    ; Deassert reset and bypass
    &mode_val=&mode_val|0x00000004|0x00000002
    data.set &pll_access_mode&pll_mode_addr %long &mode_val
  )
  else if ("&pll_type"=="sr2_pll")
  (
    ; Deassert bypass
    &mode_val=&mode_val|0x00000002
    data.set &pll_access_mode&pll_mode_addr %long &mode_val

    ; Wait for PLL to initialize
    ; The actual PLL Init time is 5us, but T32 does not seem to allow this small value
    wait 1.ms
    
    ; Deassert reset
    &mode_val=&mode_val|0x00000004
    data.set &pll_access_mode&pll_mode_addr %long &mode_val
  )
  
  ; Wait for PLL to warm up
  ; The actual PLL warm-up time is 50us, but T32 does not seem to allow this small value
  wait 1.ms
  
  ; Wait for PLL to lock
  while (data.long(&pll_access_mode&pll_status_addr)&0x10000)==0x0
  (
  )
  
  ; Assert outctrl
  &mode_val=&mode_val|0x00000001
  data.set &pll_access_mode&pll_mode_addr %long &mode_val

  ; Enable additional MPLL1 OUT EARLY DIVx CBCR if provided
  if (&pll_mpll_divx_cbcr!=0x0)
  (
    data.set &pll_access_mode&pll_mpll_divx_cbcr %long ((data.long &pll_access_mode&pll_mpll_divx_cbcr)|0x1)
  )
		  
  return


;-----------------------------------------------------------------------
; Disable PLL
;-----------------------------------------------------------------------
		  				  
Generic_PLL_Disable:

  ; Put the PLL in reset
  &mode_val=data.long(&pll_access_mode&pll_mode_addr)
  &mode_val=&mode_val&~(0x00000001|0x00000002|0x00000004)
  data.set &pll_access_mode&pll_mode_addr %LONG &mode_val
  
  return


;-----------------------------------------------------------------------
; Get votes for GCC shared PLL's
;-----------------------------------------------------------------------

Get_PLL_Vote_GCC:

  &temp_reg=data.long(&access_mode_gcc_vote&vote_reg)
  
  if (&temp_reg&0x1)==0x1
    &pll0="Y"
  else
    &pll0=" "

  if (&temp_reg&0x2)==0x2
    &pll1="Y"
  else
    &pll1=" "

  if (&temp_reg&0x4)==0x4
    &pll2="Y"
  else
    &pll2=" "

  if (&temp_reg&0x8)==0x8
    &pll3="Y"
  else
    &pll3=" "

  return
  

Display_PLL_Vote:

  print "&image |  &pll0  |  &pll1  |  &pll2  | "
  return
  
  
Reset_PLL_Votes:

  &pll0=" "
  &pll1=" "
  &pll2=" "


  return
  
 
Display_Votes:

  print " ___________      ______ _____ _____    "
  print "|\          \    |\     \     \     \   "
  print "| \          \   | \  0  \  1  \  2  \  "
  print "|  \__________\  |  \_____\_____\_____\ "
  print "|  |          |__|  |     |     |     | "
  
  gosub Reset_PLL_Votes
  &image="|\ |  RPM     |  |\"
  
  ; Get RPM votes on GCC PLL's
  &vote_reg=&HWIO_GCC_RPM_GPLL_ENA_VOTE_ADDR
  &access_mode_gcc_vote="a:"
  gosub Get_PLL_Vote_GCC

  gosub Display_PLL_Vote
  
  print "| \|__________|  | \|_____|_____|_____| "
  print "|  |          |__|  |     |     |     | "
  
  gosub Reset_PLL_Votes
  &image="|\ |  APCS    |  |\"
  
  ; Get APCS votes on GCC PLL's
  &vote_reg=&HWIO_GCC_APCS_GPLL_ENA_VOTE_ADDR
  &access_mode_gcc_vote="a:"
  gosub Get_PLL_Vote_GCC
  
  gosub Display_PLL_Vote

if (&is_q6==0)
(
  print "| \|__________|  | \|_____|_____|_____| "
  print "|  |          |__|  |     |     |     | "
  
  gosub Reset_PLL_Votes
  &image="|\ |  APCS TZ |  |\"
  
  ; Get APCS TZ votes on GCC PLL's
  &vote_reg=&HWIO_GCC_APCS_TZ_GPLL_ENA_VOTE_ADDR
  &access_mode_gcc_vote="a:"
  gosub Get_PLL_Vote_GCC
  
  gosub Display_PLL_Vote
)

  print "| \|__________|  | \|_____|_____|_____| "
  print "|  |          |__|  |     |     |     | "

  gosub Reset_PLL_Votes
  &image="|\ |  APCS HYP |  |\"

  ; Get APCS HYP votes on GCC PLLs
  &vote_reg=&HWIO_GCC_APCS_HYP_GPLL_ENA_VOTE_ADDR
  gosub Get_PLL_Vote_GCC

  gosub Display_PLL_Vote

if (&is_mpss==1)
(
  print "| \|__________|  | \|_____|_____|_____| "
  print "|  |          |__|  |     |     |     | "
  
  gosub Reset_PLL_Votes
  &image="|\ |  MSS     |  |\"
  
  ; Get MSS votes on GCC PLL's
  &vote_reg=&HWIO_GCC_MSS_Q6_GPLL_ENA_VOTE_ADDR
  &access_mode_gcc_vote="a:"
  gosub Get_PLL_Vote_GCC
  
  gosub Display_PLL_Vote
)

  
  print "| \|__________|  | \|_____|_____|_____| "
  print "|  |          |__|  |     |     |     | "
  
  gosub Reset_PLL_Votes
  &image="|\ |  WCSS    |  |\"
  
  ; Get WCSS votes on GCC PLL's
  &vote_reg=&HWIO_GCC_WCSS_GPLL_ENA_VOTE_ADDR
  &access_mode_gcc_vote="a:"
  gosub Get_PLL_Vote_GCC
  
  gosub Display_PLL_Vote

if (&is_q6==0)
(
  print "| \|__________|  | \|_____|_____|_____| "
  print "|  |          |__|  |     |     |     | "
  
  gosub Reset_PLL_Votes
  &image=" \ |  SPARE   |   \"
  
  ; Get SPARE votes on GCC PLL's
  &vote_reg=&HWIO_GCC_SPARE_GPLL_ENA_VOTE_ADDR
  &access_mode_gcc_vote="a:"
  gosub Get_PLL_Vote_GCC
  
  gosub Display_PLL_Vote
)

  print "  \|__________|    \|_____|_____|_____| "
                       
                        
  print " "
  print " "

  return

SCRIPT_END:

