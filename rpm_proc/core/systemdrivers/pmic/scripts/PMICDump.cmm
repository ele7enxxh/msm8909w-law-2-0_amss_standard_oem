; ============================================================================
;
;  PMICDump.cmm
;
;  Script to dump PMIC register values to an XML file.
;
;  Execution:
;    PMICDump.cmm [ filename ] 
;                 [ register_list_0 slaveid0_0 slaveid1_0 ]
;                 [ register_list_1 slaveid0_1 slaveid1_1 ]
;
;  <filename> is the output dump file name.  It will default to
;    c:\temp\pmicdump.xml
;
;  The next three parameters define how to dump one of the PMICs on the
;  platform.  Either 0, 1 or 2 sets can be provided.  If none are provided
;  then the interactive dialog window will be shown.
;
;  <register_list_x> is a file containing a list of register addresses.
;  <slaveidx_y> are the SPMI slave ids for the two PMIC slaves.
;
;  ====================================================================
;
;  Copyright (c) 2012-2015 QUALCOMM Technologies Incorporated.  All Rights Reserved.
;  QUALCOMM Proprietary and Confidential.
;
;  ====================================================================
;
;  $Header: //components/rel/rpm.bf/2.1.1/core/systemdrivers/pmic/scripts/PMICDump.cmm#3 $
;  $DateTime: 2015/10/01 04:31:41 $
;  $Author: pwbldsvc $
;
; ============================================================================
;

ENTRY &dumpfile &pm0_reglist &pm0_sid0 &pm0_sid1 &pm1_reglist &pm1_sid0 &pm1_sid1

;-----------------------------------------------------------------------------
; SPMI variables
;-----------------------------------------------------------------------------

&PMIC_ARB_CHNLn_CMD=0x2400000
&PMIC_ARB_CHNLn_STATUS=0x2400008
&PMIC_ARB_CHNLn_WDATA0=0x2400010
&PMIC_ARB_CHNLn_RDATA0=0x2400018
&PMIC_ARB_CHNLn_ADDR=0x200f800
&PMIC_ARB_PERIPHn_OWNER_ADDR=0x200a700
&SPMI_HW_VERSION=0x200af0c
&CHNLn_OFFSET=0x8000
&OWNERn_OFFSET=0x1000
&MAX_SPMI_CHANNELS=255.

&SPMIOwnerChannel=0  ; APCS Channel by default

;-----------------------------------------------------------------------------
; Default bus access mode
;-----------------------------------------------------------------------------

&BusAccessMode="A"

;-----------------------------------------------------------------------------
; REV ID PERIPHERAL TYPE AND SUBTYPES (VERSION DETECTION)
;-----------------------------------------------------------------------------

LOCAL &PM_REVID_PERIPH_TYPE_QC_PMIC
&PM_REVID_PERIPH_TYPE_QC_PMIC=0x51

LOCAL &PM_REVID_PERIPH_SUBTYPES_MAX_NUM
&PM_REVID_PERIPH_SUBTYPES_MAX_NUM=20

VAR.NEW char[&PM_REVID_PERIPH_SUBTYPES_MAX_NUM][10] \RevidPeriphSubtypeNamesArr

VAR.NEW int \i
VAR.SET \i=0
VAR.WHILE \i<&PM_REVID_PERIPH_SUBTYPES_MAX_NUM
	VAR.SET \RevidPeriphSubtypeNamesArr[\i++]="UNKNOWN"

VAR.SET \RevidPeriphSubtypeNamesArr[1]="PM8941"
VAR.SET \RevidPeriphSubtypeNamesArr[2]="PM8841"
VAR.SET \RevidPeriphSubtypeNamesArr[3]="PMD9607"
VAR.SET \RevidPeriphSubtypeNamesArr[4]="PM8026"
VAR.SET \RevidPeriphSubtypeNamesArr[5]="PM8110"
VAR.SET \RevidPeriphSubtypeNamesArr[6]="PMA8084"
VAR.SET \RevidPeriphSubtypeNamesArr[7]="PMI8962"
VAR.SET \RevidPeriphSubtypeNamesArr[8]="PMD9645"
VAR.SET \RevidPeriphSubtypeNamesArr[9]="PM8994"
VAR.SET \RevidPeriphSubtypeNamesArr[10]="PMI8994"
VAR.SET \RevidPeriphSubtypeNamesArr[11]="PM8916"
VAR.SET \RevidPeriphSubtypeNamesArr[12]="PM8004"
VAR.SET \RevidPeriphSubtypeNamesArr[13]="PM8909"
VAR.SET \RevidPeriphSubtypeNamesArr[14]="PM2433"
VAR.SET \RevidPeriphSubtypeNamesArr[16]="PM8950"
VAR.SET \RevidPeriphSubtypeNamesArr[17]="PMI8950"
VAR.SET \RevidPeriphSubtypeNamesArr[18]="PMK8001"

LOCAL &PM_MAX_NUM_PMICS &PM_MAX_NUM_SLAVE_IDS
&PM_MAX_NUM_SLAVE_IDS=14.
&PM_MAX_NUM_PMICS=7.

VAR.NEW char[&PM_MAX_NUM_PMICS] \PmicModelTypeValueArr

VAR.NEW int \i
VAR.SET \i=0
VAR.WHILE \i<&PM_MAX_NUM_PMICS
	VAR.SET \PmicModelTypeValueArr[\i++]=0

VAR.NEW int[&PM_MAX_NUM_PMICS] \PmicSlaveIdArr

VAR.NEW int \i
VAR.SET \i=0
VAR.WHILE \i<&PM_MAX_NUM_PMICS
	VAR.SET \PmicSlaveIdArr[\i++]=0

VAR.NEW char[&PM_MAX_NUM_PMICS] \PmicModelSubTypeValueArr

VAR.NEW int \i
VAR.SET \i=0
VAR.WHILE \i<&PM_MAX_NUM_PMICS
	VAR.SET \PmicModelSubTypeValueArr[\i++]=0

VAR.NEW int[&PM_MAX_NUM_PMICS] \PmicAllLayerRevArr

VAR.NEW int \i
VAR.SET \i=0
VAR.WHILE \i<&PM_MAX_NUM_PMICS
	VAR.SET \PmicAllLayerRevArr[\i++]=0

VAR.NEW int[&PM_MAX_NUM_PMICS] \PmicMetalRevArr

VAR.NEW int \i
VAR.SET \i=0
VAR.WHILE \i<&PM_MAX_NUM_PMICS
	VAR.SET \PmicMetalRevArr[\i++]=0

LOCAL &PM_VERSION_DETECT_FLAG
&PM_VERSION_DETECT_FLAG=0

LOCAL &PM_REGISTER_LIST_FILE_NAME &PM_FLAT_FILE_NAME
&PM_REGISTER_LIST_FILE_NAME="PMICRegisterList.txt"
&PM_FLAT_FILE_NAME="CORE_ADDRESS_FILE_CUSTOMER.FLAT"

;-----------------------------------------------------------------------------
; CUSTOMIZED DUMP VARIABLES
;-----------------------------------------------------------------------------

VAR.NEW char[&PM_MAX_NUM_PMICS][500] \CustomRegisterListArr

VAR.NEW int \i
VAR.SET \i=0
VAR.WHILE \i<&PM_MAX_NUM_PMICS
	VAR.SET \CustomRegisterListArr[\i++]="#&PM_REGISTER_LIST_FILE_NAME"

VAR.NEW char[&PM_MAX_NUM_PMICS][500] \CustomFlatFileArr

VAR.NEW int \i
VAR.SET \i=0
VAR.WHILE \i<&PM_MAX_NUM_PMICS
	VAR.SET \CustomFlatFileArr[\i++]="#&PM_FLAT_FILE_NAME"

VAR.NEW int[&PM_MAX_NUM_PMICS] \CustomDumpFlagArr

VAR.NEW int \i
VAR.SET \i=0
VAR.WHILE \i<&PM_MAX_NUM_PMICS
	VAR.SET \CustomDumpFlagArr[\i++]=0

VAR.NEW int[&PM_MAX_NUM_PMICS] \CustomFileLocFlagArr

VAR.NEW int \i
VAR.SET \i=0
VAR.WHILE \i<&PM_MAX_NUM_PMICS
	VAR.SET \CustomFileLocFlagArr[\i++]=0

;-----------------------------------------------------------------------------
; Set up local pmic index to determine which PMIC is selected from pull down
; for customized dump
;-----------------------------------------------------------------------------

LOCAL &CURRENT_PULLDOWN_PMIC_INDEX
&CURRENT_PULLDOWN_PMIC_INDEX=&PM_MAX_NUM_PMICS

AREA.SELECT A000
AREA.CLEAR A000

;-----------------------------------------------------------------------------
; Determine the file name to save to.
;-----------------------------------------------------------------------------

IF "&dumpfile"==""
(
  &dumpfile="c:\temp\pmicdump.xml"
)

;-----------------------------------------------------------------------------
; Set up local flag for whether to include the trim registers or not.
;-----------------------------------------------------------------------------

LOCAL &include_trim
&include_trim=1

;-----------------------------------------------------------------------------
; Check for non-interactive mode.
;-----------------------------------------------------------------------------

IF "&pm0_reglist"!=""
(
  GOSUB SetOwnerChannel
  GOSUB StartDump
  GOSUB DumpPMIC &pm0_reglist &pm0_sid0 &pm0_sid1
  IF "&pm1_reglist"!=""
  (
    GOSUB DumpPMIC &pm1_reglist &pm1_sid0 &pm1_sid1
  )
  GOSUB CloseDump 
  PRINT "PMIC Dump Complete"
  
  ENDDO
)

;-----------------------------------------------------------------------------
; Create the dialog
;-----------------------------------------------------------------------------

DIALOG
(
  HEADER "PMIC Register Dump Tool"
   
  POS 0. 0. 35. 5.
  BOX "Configuration"
  
  POS 1. 1.5 10. 1.
  TEXT "Log File:"
  POS 12. 1.5 20. 1.
  LOGFILE: EDIT "c:\temp\pmicdump.xml" ""

  POS 1. 3. 10. 1.
  TEXT20: TEXT "IncludeTrim:"
  POS 12. 3. 1.5 1.
  TRIM.CHK: CHECKBOX "" ""
   
  POS 0. 5.5 35. 9.5
  BOX "Customize"

  POS 1. 7. 12. 1.
  TEXT20: TEXT "Default Settings:"
  POS 13.5 7. 1.5 1.
  DEFAULT.CHK: CHECKBOX "" "GOSUB DefaultCheckToggle"
  
  POS 1. 8.5 7. 1.
  PMIC_MODEL_TXT: TEXT "PMIC:"
  POS 12. 8.5 8. 1.
  PMIC_MODEL_PD: DYNPULLDOWN ",PMIC A,PMIC B,PMIC C,PMIC D,PMIC E,PMIC F,PMIC G" "GOSUB CustomizeDumpConfig"
  (
  )
  POS 21. 8.5 10. 1.
  PMIC_MODEL_DATA: DYNTEXT ""
  
  POS 1. 10. 10. 1.
  TEXT "Register List:"
  POS 12. 10. 20. 1.
  REGLIST: EDIT "" ""
  
  POS 1. 11.5 10. 1.
  TEXT "Flat File:"
  POS 12. 11.5 20. 1.
  FLATFILE: EDIT "" ""

  POS 1. 13. 12. 1.
  TEXT20: TEXT "Collect Dump:"
  POS 13.5 13. 1.5 1.
  COLLECT_DUMP.CHK: CHECKBOX "" "GOSUB CollectDumpCheckToggle"
  
  POS 1. 16. 11. 1.5
  DEFBUTTON "Dump" 
  (
    GOSUB SetOwnerChannel
    &analyzeFlag=0
    GOSUB CollectAndAnalyzeDump &analyzeFlag
  )

  POS 13. 16. 12. 1.5
  DEFBUTTON "Dump + Analyze" 
  (
    GOSUB SetOwnerChannel
    &analyzeFlag=1

    GOSUB CollectAndAnalyzeDump &analyzeFlag
  )

  POS 27. 16. 10. 1.5
  BUTTON "Close" "JUMPTO winclose"
  CLOSE "JUMPTO winclose"
)
DIALOG.SET DEFAULT.CHK
DIALOG.DISABLE PMIC_MODEL_PD
DIALOG.DISABLE REGLIST
DIALOG.DISABLE FLATFILE
DIALOG.DISABLE COLLECT_DUMP.CHK
STOP

winclose:
DIALOG.END
ENDDO


;=============================================================================
;=============================================================================
; SUBROUTINES
;=============================================================================
;=============================================================================

;=============================================================================
; SUB: PmicVersionDetection
;=============================================================================

PmicVersionDetection:

  &verPeriphBaseAddr=0x100
  &verMetalRevAddr=&verPeriphBaseAddr+0x02
  &verAllLayerRevAddr=&verPeriphBaseAddr+0x03
  &verPeriphTypeAddr=&verPeriphBaseAddr+0x04
  &verPeriphSubTypeAddr=&verPeriphBaseAddr+0x05
  &verMetalRevData=0
  &verAllLayerRevData=0
  &verPeriphTypeData=0
  &verPeriphSubTypeData=0
  &verSlaveId=0
  &verDeviceIndex=0
  &status=0 
  &breakFlag=0

  IF (STATE.RUN()&&(SYSTEM.MODE()>0x5)&&("&BusAccessMode"=="A"))
  (
    &breakFlag=1
    b
    WAIT 1.ms
  )

  IF (DATA.LONG(&BusAccessMode:&SPMI_HW_VERSION)==0x20010000)
  (
    &MAX_SPMI_CHANNELS=127.
  )

  IF (&breakFlag==1)
  (
    g
  )

  WHILE (&verSlaveId<=&PM_MAX_NUM_SLAVE_IDS)
  (
    IF (&verDeviceIndex<&PM_MAX_NUM_PMICS)
    (
      GOSUB SPMIRead &verPeriphTypeAddr &verSlaveId
      ENTRY &status &verPeriphTypeData

      IF ((&status!=0)&&(&verPeriphTypeData!=0)&&(&verPeriphTypeData==&PM_REVID_PERIPH_TYPE_QC_PMIC))
      (
        GOSUB SPMIRead &verPeriphSubTypeAddr &verSlaveId
        ENTRY &status &verPeriphSubTypeData
        GOSUB SPMIRead &verAllLayerRevAddr &verSlaveId
        ENTRY &status &verAllLayerRevData
        GOSUB SPMIRead &verMetalRevAddr &verSlaveId
        ENTRY &status &verMetalRevData

        IF (&verPeriphSubTypeData!=1)
        (
          IF (&verAllLayerRevData<1)
          (
            &verAllLayerRevData=&verAllLayerRevData+1
          )
        )
        ELSE
        (
          IF (&verAllLayerRevData<2)
          (
            &verAllLayerRevData=&verAllLayerRevData+1
          )
        )

        VAR.SET \PmicSlaveIdArr[&verDeviceIndex]=&verSlaveId
        VAR.SET \PmicModelSubTypeValueArr[&verDeviceIndex]=&verPeriphSubTypeData
        VAR.SET \PmicAllLayerRevArr[&verDeviceIndex]=&verAllLayerRevData
        VAR.SET \PmicMetalRevArr[&verDeviceIndex]=&verMetalRevData
      )
    )
    &verDeviceIndex=&verDeviceIndex+1
    &verSlaveId=&verSlaveId+2
  )

  &PM_VERSION_DETECT_FLAG=1

  AREA.SELECT A000
  AREA.CLEAR A000

  RETURN


;=============================================================================
; SUB: SetOwnerChannel
;=============================================================================

SetOwnerChannel:

  &PMIC_ARB_CHNLn_CMD=0x2400000
  &PMIC_ARB_CHNLn_STATUS=0x2400008
  &PMIC_ARB_CHNLn_WDATA0=0x2400010
  &PMIC_ARB_CHNLn_RDATA0=0x2400018
  &PMIC_ARB_CHNLn_ADDR=0x200f800
  &PMIC_ARB_PERIPHn_OWNER_ADDR=0x200a700
  &SPMI_HW_VERSION=0x200af0c

  &cpu="SYS.CPU()"

  IF &cpu=="CortexM3"
  (
    &SPMIOwnerChannel=4

    IF "&BusAccessMode"=="A"
    (
      &PMIC_ARB_CHNLn_CMD=0x62400000
      &PMIC_ARB_CHNLn_STATUS=0x62400008
      &PMIC_ARB_CHNLn_WDATA0=0x62400010
      &PMIC_ARB_CHNLn_RDATA0=0x62400018
      &PMIC_ARB_CHNLn_ADDR=0x6200f800
      &PMIC_ARB_PERIPHn_OWNER_ADDR=0x6200a700
      &SPMI_HW_VERSION=0x6200af0c
    )
  )

  RETURN


;=============================================================================
; SUB: DefaultCheckToggle
;=============================================================================

DefaultCheckToggle:

  IF DIALOG.BOOLEAN(DEFAULT.CHK)
  (
    DIALOG.DISABLE PMIC_MODEL_PD
    DIALOG.DISABLE REGLIST
    DIALOG.DISABLE FLATFILE
    DIALOG.DISABLE COLLECT_DUMP.CHK
  )
  ELSE
  (
    DIALOG.ENABLE PMIC_MODEL_PD
  )

  RETURN


;=============================================================================
; SUB: CustomizeDumpConfig
;=============================================================================

CustomizeDumpConfig:

  &pmicModelValue=0

  &reglistStatus=0
  &reglist=""
  &flatfileStatus=0
  &flatfile=""

  IF (&PM_VERSION_DETECT_FLAG==0)
  (
    IF (STATE.RUN()&&(SYSTEM.MODE()>0x5))
    (
      b
      GOSUB PmicVersionDetection
      g
    )
    ELSE
    (
      GOSUB PmicVersionDetection
    )
  )

  IF (&CURRENT_PULLDOWN_PMIC_INDEX<&PM_MAX_NUM_PMICS)
  (
    &reglistCustom=STRING.REPLACE(DIALOG.STRING(REGLIST),"\","#",0.)
    &flatfileCustom=STRING.REPLACE(DIALOG.STRING(FLATFILE),"\","#",0.)
    VAR.SET \CustomRegisterListArr[&CURRENT_PULLDOWN_PMIC_INDEX]="&reglistCustom"
    VAR.SET \CustomFlatFileArr[&CURRENT_PULLDOWN_PMIC_INDEX]="&flatfileCustom"
  )

  IF (DIALOG.STRING(PMIC_MODEL_PD)=="PMIC A")
  (
    &CURRENT_PULLDOWN_PMIC_INDEX=0.
  )
  ELSE IF (DIALOG.STRING(PMIC_MODEL_PD)=="PMIC B")
  (
    &CURRENT_PULLDOWN_PMIC_INDEX=1.
  )
  ELSE IF (DIALOG.STRING(PMIC_MODEL_PD)=="PMIC C")
  (
    &CURRENT_PULLDOWN_PMIC_INDEX=2.
  )
  ELSE IF (DIALOG.STRING(PMIC_MODEL_PD)=="PMIC D")
  (
    &CURRENT_PULLDOWN_PMIC_INDEX=3.
  )
  ELSE IF (DIALOG.STRING(PMIC_MODEL_PD)=="PMIC E")
  (
    &CURRENT_PULLDOWN_PMIC_INDEX=4.
  )
  ELSE IF (DIALOG.STRING(PMIC_MODEL_PD)=="PMIC F")
  (
    &CURRENT_PULLDOWN_PMIC_INDEX=5.
  )
  ELSE IF (DIALOG.STRING(PMIC_MODEL_PD)=="PMIC G")
  (
    &CURRENT_PULLDOWN_PMIC_INDEX=6.
  )
  ELSE
  (
    &CURRENT_PULLDOWN_PMIC_INDEX=&PM_MAX_NUM_PMICS
    DIALOG.SET PMIC_MODEL_DATA ""
    DIALOG.SET REGLIST ""
    DIALOG.SET FLATFILE ""

    DIALOG.DISABLE REGLIST
    DIALOG.DISABLE FLATFILE
    DIALOG.DISABLE COLLECT_DUMP.CHK
    AREA.SELECT A000
    AREA.CLEAR A000
    RETURN
  )

  &pmicModelValue=VAR.VALUE(\PmicModelSubTypeValueArr[&CURRENT_PULLDOWN_PMIC_INDEX])
  IF (&pmicModelValue!=0)
  (
    &model=VAR.STRING(\RevidPeriphSubtypeNamesArr[&pmicModelValue])
    &pmicAllLayerRev=FORMAT.DECIMAL(0,VAR.VALUE(\PmicAllLayerRevArr[&CURRENT_PULLDOWN_PMIC_INDEX]))
    &pmicMetalRev=FORMAT.DECIMAL(0,VAR.VALUE(\PmicMetalRevArr[&CURRENT_PULLDOWN_PMIC_INDEX]))

    DIALOG.SET PMIC_MODEL_DATA "&model"+"v"+"&pmicAllLayerRev"+"."+"&pmicMetalRev"

    IF (VAR.VALUE(\CustomFileLocFlagArr[&CURRENT_PULLDOWN_PMIC_INDEX])==0)
    (
      GOSUB GetDefaultDumpFiles &model &pmicAllLayerRev &pmicMetalRev
      ENTRY &reglistStatus &reglist &flatfileStatus &flatfile
      IF (&reglistStatus==1)
      (
        &reglistTemp=STRING.REPLACE("&reglist","\","#",0.)
        VAR.SET \CustomRegisterListArr[&CURRENT_PULLDOWN_PMIC_INDEX]="&reglistTemp"
      )

      IF (&flatfileStatus==1)
      (
        &flatfileTemp=STRING.REPLACE("&flatfile","\","#",0.)
        VAR.SET \CustomFlatFileArr[&CURRENT_PULLDOWN_PMIC_INDEX]="&flatfileTemp" 
      )

      VAR.SET \CustomFileLocFlagArr[&CURRENT_PULLDOWN_PMIC_INDEX]=1
    )

    DIALOG.SET REGLIST STRING.REPLACE(VAR.STRING(\CustomRegisterListArr[&CURRENT_PULLDOWN_PMIC_INDEX]),"#","\",0.)
    DIALOG.SET FLATFILE STRING.REPLACE(VAR.STRING(\CustomFlatFileArr[&CURRENT_PULLDOWN_PMIC_INDEX]),"#","\",0.)

    DIALOG.ENABLE REGLIST
    DIALOG.ENABLE FLATFILE
    DIALOG.ENABLE COLLECT_DUMP.CHK

    IF (VAR.VALUE(\CustomDumpFlagArr[&CURRENT_PULLDOWN_PMIC_INDEX])==1)
    (
      DIALOG.SET COLLECT_DUMP.CHK "ON"
    )
    ELSE
    (
      DIALOG.SET COLLECT_DUMP.CHK "OFF"
    )
  )
  ELSE
  (
    DIALOG.SET PMIC_MODEL_DATA "NO PMIC"
    DIALOG.SET REGLIST STRING.REPLACE(VAR.STRING(\CustomRegisterListArr[&CURRENT_PULLDOWN_PMIC_INDEX]),"#","\",0.)
    DIALOG.SET FLATFILE STRING.REPLACE(VAR.STRING(\CustomFlatFileArr[&CURRENT_PULLDOWN_PMIC_INDEX]),"#","\",0.)

    DIALOG.DISABLE REGLIST
    DIALOG.DISABLE FLATFILE
    DIALOG.DISABLE COLLECT_DUMP.CHK
  )
  AREA.SELECT A000
  AREA.CLEAR A000

  RETURN


;=============================================================================
; SUB: CollectDumpCheckToggle
;=============================================================================

CollectDumpCheckToggle:

  IF DIALOG.BOOLEAN(COLLECT_DUMP.CHK)
  (
    &reglistCustom=STRING.REPLACE(DIALOG.STRING(REGLIST),"\","#",0.)
    &flatfileCustom=STRING.REPLACE(DIALOG.STRING(FLATFILE),"\","#",0.)
    VAR.SET \CustomRegisterListArr[&CURRENT_PULLDOWN_PMIC_INDEX]="&reglistCustom"
    VAR.SET \CustomFlatFileArr[&CURRENT_PULLDOWN_PMIC_INDEX]="&flatfileCustom"
    VAR.SET \CustomDumpFlagArr[&CURRENT_PULLDOWN_PMIC_INDEX]=1
  )
  ELSE
  (
    VAR.SET \CustomRegisterListArr[&CURRENT_PULLDOWN_PMIC_INDEX]="#&PM_REGISTER_LIST_FILE_NAME"
    VAR.SET \CustomFlatFileArr[&CURRENT_PULLDOWN_PMIC_INDEX]="#&PM_FLAT_FILE_NAME"
    VAR.SET \CustomDumpFlagArr[&CURRENT_PULLDOWN_PMIC_INDEX]=0
  )
  AREA.SELECT A000
  AREA.CLEAR A000

  RETURN

;=============================================================================
; SUB: CollectAndAnalyzeDump
;=============================================================================

CollectAndAnalyzeDump:
  ENTRY &analyzeFlag
    
  &pmicIndex=0
  &pmicModelType=0
  &model=""
  &pmicAllLayerRev=0
  &pmicMetalRev=0
  &pmicSlaveId0=0
  &pmicSlaveId1=0
  &pmicDetectedFlag=0
  &reglistStatus=0
  &reglist=""
  &flatfileStatus=0
  &flatfile=""
  &dumpStatus=0 ; 0 - Failure, 1 - Success

  IF (STATE.RUN()&&(SYSTEM.MODE()>0x5))
  (
    b
  )

  IF (&PM_VERSION_DETECT_FLAG==0)
  (
    GOSUB PmicVersionDetection
  )

  &dumpfile=DIALOG.STRING(LOGFILE)
  GOSUB StartDump

  IF DIALOG.BOOLEAN(TRIM.CHK)
  (
    &include_trim=1
  )
  ELSE
  (
    &include_trim=0
  )

  IF (!DIALOG.BOOLEAN(DEFAULT.CHK)&&DIALOG.BOOLEAN(COLLECT_DUMP.CHK))
  (
    &reglistCustom=STRING.REPLACE(DIALOG.STRING(REGLIST),"\","#",0.)
    &flatfileCustom=STRING.REPLACE(DIALOG.STRING(FLATFILE),"\","#",0.)
    VAR.SET \CustomRegisterListArr[&CURRENT_PULLDOWN_PMIC_INDEX]="&reglistCustom"
    VAR.SET \CustomFlatFileArr[&CURRENT_PULLDOWN_PMIC_INDEX]="&flatfileCustom"
    AREA.SELECT A000
    AREA.CLEAR A000
  )

  AREA
  PRINT " "

  WHILE (&pmicIndex<&PM_MAX_NUM_PMICS)
  (
    &pmicModelValue=VAR.VALUE(\PmicModelSubTypeValueArr[&pmicIndex])
    IF (&pmicModelValue!=0)
    (
      &pmicDetectedFlag=1
      &reglistStatus=0
      &model=VAR.STRING(\RevidPeriphSubtypeNamesArr[&pmicModelValue])
      &pmicAllLayerRev=FORMAT.DECIMAL(0,VAR.VALUE(\PmicAllLayerRevArr[&pmicIndex]))
      &pmicMetalRev=FORMAT.DECIMAL(0,VAR.VALUE(\PmicMetalRevArr[&pmicIndex]))
      &pmicSlaveId0=VAR.VALUE(\PmicSlaveIdArr[&pmicIndex])
      &pmicSlaveId1=VAR.VALUE(\PmicSlaveIdArr[&pmicIndex])+1
      &sid0="&pmicSlaveId0"
      &sid1="&pmicSlaveId1"

      PRINT "Collecting &model"+"v"+"&pmicAllLayerRev.&pmicMetalRev pmic register dump..."

      IF DIALOG.BOOLEAN(DEFAULT.CHK)
      (
        GOSUB GetDefaultDumpFiles &model &pmicAllLayerRev &pmicMetalRev
        ENTRY &reglistStatus &reglist &flatfileStatus &flatfile
        IF (&reglistStatus==1)
        (
          &dumpStatus=1
          GOSUB DumpPMIC &reglist &sid0 &sid1 &model
        )
      )
      ELSE
      (
        IF (VAR.VALUE(\CustomDumpFlagArr[&pmicIndex])==1)
        (
          &reglist=STRING.REPLACE(VAR.STRING(\CustomRegisterListArr[&pmicIndex]),"#","\",0.)
          IF (FILE.EXIST(&reglist))
          (
            &reglistStatus=1
            &dumpStatus=1
            GOSUB DumpPMIC &reglist &sid0 &sid1 &model
          )
          ELSE
          (
            ;if register list not found return error
            PRINT "ERROR: &model register list not found"
          )
        )
        ELSE
        (
          ;Dump flag is disabled for this pmic index
          ;so setting this flag to avoid printing error
          &reglistStatus=1
          PRINT "&model PMIC 'Collect Dump' checkbox disabled"
        )
      )
    )
    &pmicIndex=&pmicIndex+1
  )

  ;if register list not found return error
  IF (&dumpStatus==1)
  (
    PRINT "PMIC register dump sent to &dumpfile"
  )
  ELSE
  (
    PRINT "PMIC register dump collection failed"
  )

  GOSUB CloseDump

  IF (&pmicDetectedFlag==0)
  (
    PRINT "ERROR: PMIC detection failed"
  )

  IF ((&analyzeFlag==1)&&(&dumpStatus==1))
  (
    GOSUB AnalyzeDump
  )

  RETURN

;=============================================================================
; SUB: AnalyzeDump
;=============================================================================

AnalyzeDump:
  &pmicIndex=0
  &pmicModelType=0
  &model=0
  &pmicAllLayerRev=0
  &pmicMetalRev=0
  &reglistStatus=0
  &reglist=""
  &flatfileStatus=0
  &flatfile=""
  &parseDumpIndex=0

  WHILE (&pmicIndex<&PM_MAX_NUM_PMICS)
  (
    &pmicModelValue=VAR.VALUE(\PmicModelSubTypeValueArr[&pmicIndex])
    IF (&pmicModelValue!=0)
    (
      &model=VAR.STRING(\RevidPeriphSubtypeNamesArr[&pmicModelValue])
      &pmicAllLayerRev=FORMAT.DECIMAL(0,VAR.VALUE(\PmicAllLayerRevArr[&pmicIndex]))
      &pmicMetalRev=FORMAT.DECIMAL(0,VAR.VALUE(\PmicMetalRevArr[&pmicIndex]))

      PRINT "Parsing &model"+"v"+"&pmicAllLayerRev.&pmicMetalRev pmic register dump..."

      ; Check if default settings or customized settings
      IF DIALOG.BOOLEAN(DEFAULT.CHK)
      (
        GOSUB GetDefaultDumpFiles &model &pmicAllLayerRev &pmicMetalRev
        ENTRY &reglistStatus &reglist &flatfileStatus &flatfile

        IF (&flatfileStatus==1)
        (
          ;Depending on number of PMIC dumps collected, index used for parsing is decided
          GOSUB ParseDump &parseDumpIndex &model &flatfile
          &parseDumpIndex=&parseDumpIndex+1
        )
      )
      ELSE
      (
        IF (VAR.VALUE(\CustomDumpFlagArr[&pmicIndex])==1)
        (
          &flatfile=STRING.REPLACE(VAR.STRING(\CustomFlatFileArr[&pmicIndex]),"#","\",0.)
          IF (FILE.EXIST(&flatfile))
          (
            &flatfileStatus=1

            ;Depending on number of PMIC dumps collected, index used for parsing is decided
            GOSUB ParseDump &parseDumpIndex &model &flatfile
            &parseDumpIndex=&parseDumpIndex+1
          )
          ELSE
          (

            ;if flat file not found return error
            PRINT "ERROR: &model flat file not found"
          )
        )
        ELSE
        (
          ;Collect Dump flag is disabled for this pmic index
          ;so setting this flag to avoid printing error
          PRINT "&model PMIC 'Collect Dump' checkbox disabled"
          &flatfileStatus=1
        )
      )
    )
    &pmicIndex=&pmicIndex+1
  )

  RETURN

;=============================================================================
; SUB: GetDefaultDumpFiles
;=============================================================================

GetDefaultDumpFiles:
  ENTRY &model &pmicAllLayerRev &pmicMetalRev

  &reglistStatus=0
  &reglist=""
  &reglistTempAllLayer=""
  &reglistTempAllLayerMetal=""

  &flatfileStatus=0
  &flatfile=""
  &flatfileTempAllLayer=""
  &flatfileTempAllLayerMetal=""

  WHILE ((&pmicAllLayerRev>0)&&(&reglistStatus==0))
  (
    &pmicAllLayerRev=FORMAT.DECIMAL(0,&pmicAllLayerRev)
    &pmicMetalRev=FORMAT.DECIMAL(0,&pmicMetalRev)

    &reglistTempAllLayer="&model"+"\v"+"&pmicAllLayerRev"+"\"+"&PM_REGISTER_LIST_FILE_NAME"
    &reglistTempAllLayerMetal="&model"+"\v"+"&pmicAllLayerRev"+"_"+"&pmicMetalRev"+"\"+"&PM_REGISTER_LIST_FILE_NAME"

    &flatfileTempAllLayer="&model"+"\v"+"&pmicAllLayerRev"+"\"+"&PM_FLAT_FILE_NAME"
    &flatfileTempAllLayerMetal="&model"+"\v"+"&pmicAllLayerRev"+"_"+"&pmicMetalRev"+"\"+"&PM_FLAT_FILE_NAME"

    IF (FILE.EXIST(&reglistTempAllLayer))
    (
      &reglist="&reglistTempAllLayer"
      &reglistStatus=1
    )
    ELSE IF (FILE.EXIST(&reglistTempAllLayerMetal))
    (
      &reglist="&reglistTempAllLayerMetal"
      &reglistStatus=1
    )

    IF (FILE.EXIST(&flatfileTempAllLayer))
    (
      &flatfile="&flatfileTempAllLayer"
      &flatfileStatus=1
    )
    ELSE IF (FILE.EXIST(&flatfileTempAllLayerMetal))
    (
      &flatfile="&flatfileTempAllLayerMetal"
      &flatfileStatus=1
    )
    &pmicAllLayerRev=&pmicAllLayerRev-1
  )
  
  RETURN &reglistStatus &reglist &flatfileStatus &flatfile

;=============================================================================
; SUB: StartDump
;=============================================================================

StartDump:
  ENTRY &target
  OPEN #1 &dumpfile /Create
  WRITE #1 "<pmicDump version='1'>"
  WRITE #1 "  <timestamp>" CLOCK.DATE() ", " CLOCK.TIME() "</timestamp>"
  WRITE #1 "  <generator>Trace32</generator>"

  if "&target"==""
  (
    WRITE #1 "  <target>"
  )
  ELSE
  (
    WRITE #1 "  <target name='&target'>"
  )

  RETURN


;=============================================================================
; SUB: DumpPMIC
;=============================================================================

DumpPMIC:

  ENTRY &reglist &sid0 &sid1 &pmic
  LOCAL &spmi_slave
  GLOBAL &ReadValue
  &wdog_sid=0
  &wdog_addr=0x857
  &wdog_status=0
  &wdog_data=0

  ;-----------------------------------------------------------------------------
  ; Disable PMIC Watchdog before collecting dumps
  ;-----------------------------------------------------------------------------

  GOSUB SPMIWrite &wdog_addr &wdog_sid &wdog_data
  ENTRY &wdog_status

  ;-----------------------------------------------------------------------------
  ; Add header information.
  ;-----------------------------------------------------------------------------

  IF "&pmic"==""
  (
    WRITE #1 "    <pmic>"
  )
  ELSE
  (
    WRITE #1 "    <pmic model='&pmic'>"
  )
  WRITE #1 "      <bus type='spmi' slaveid0='&sid0' slaveid1='&sid1' />"

  ;-----------------------------------------------------------------------------
  ; Save each register value.
  ;-----------------------------------------------------------------------------

  OPEN #2 &reglist /Read

  READ #2 %line &addr
  
  WHILE !EOF()
  (
    &pmic_sid=&addr>>16.
    IF &pmic_sid==0
    (
      &spmi_slave=&sid0
    )
    ELSE IF &pmic_sid==1
    (
      &spmi_slave=&sid1
    )
    ELSE
    (
      &spmi_slave=0xFF
    )

    IF "&spmi_slave"!="0xFF"
    (
      &spmi_addr=&addr&0xFFFF
      &spmi_offset=&addr&0xFF
      IF (&include_trim==1)||(&spmi_offset<0xF0)
      (
        GOSUB SPMIRead &spmi_addr &spmi_slave
        ENTRY &status &data
        IF (&status==1)
        (
          WRITE #1 "      <register address='0x" &addr "' value='0x" &data "' />"
        )
      )
    )

    READ #2 %line &addr
  )

  ;-----------------------------------------------------------------------------
  ; Close up the XML element.
  ;-----------------------------------------------------------------------------

  WRITE #1 "    </pmic>"

  RETURN


;=============================================================================
; SUB: CloseDump
;=============================================================================

CloseDump:
  WRITE #1 "  </target>"
  WRITE #1 "</pmicDump>"
  CLOSE #1

  RETURN


;=============================================================================
; SUB: ParseDump
;=============================================================================

ParseDump:
  ENTRY &devidx &model &flat
  LOCAL &fname

  &fname="&dumpfile.&model.txt"
  &pwd=OS.PWD()
  &parser_cmd="&pwd"+"\"+"PMICDumpParser.py"
  &devidx=FORMAT.DECIMAL(0,&devidx)

  IF ((STRING.SCAN("&flat","\\",0)!=0)&&(STRING.SCAN("&flat","//",0)!=0))
  (
    &flat="&pwd"+"\"+"&flat"
  )

  OS.COMMAND start python &parser_cmd --flat=&flat --file=&dumpfile --output=&fname --devidx=&devidx

  PRINT "PMIC register dump parsed to &fname"

  RETURN


;=============================================================================
; SUB: SPMIRead
;=============================================================================

SPMIRead:

  ENTRY &RegisterAddress &SlaveId

  &RegisterOffset=(&RegisterAddress)&0xFF
  &RegisterBase=((&RegisterAddress)&0xFF00)|(&SlaveId<<0x10)
  &RegisterOwner=(((&RegisterAddress<<0x8)&0xFF0000)|(&SlaveId<<0x8))|&SPMIOwnerChannel
  &SPMIChannel=&MAX_SPMI_CHANNELS
  &breakFlag=0

  IF (STATE.RUN()&&(SYSTEM.MODE()>0x5)&&("&BusAccessMode"=="A"))
  (
    &breakFlag=1
    b
    WAIT 1.ms
  )

  DATA.SET &BusAccessMode:&PMIC_ARB_CHNLn_ADDR+(4*&SPMIChannel) %LONG &RegisterBase

  DATA.SET &BusAccessMode:&PMIC_ARB_PERIPHn_OWNER_ADDR+(4*&SPMIChannel) %LONG &RegisterOwner

  &cmd=(0x1<<0x1B)|(&RegisterOffset<<0x4)

  DATA.SET &BusAccessMode:&PMIC_ARB_CHNLn_CMD+&OWNERn_OFFSET*&SPMIOwnerChannel+&CHNLn_OFFSET*&SPMIChannel %LONG &cmd

  &status=0
  &data=0

  WHILE (&status==0)
  (
    WAIT 1.ms
    &status=DATA.LONG(&BusAccessMode:&PMIC_ARB_CHNLn_STATUS+&OWNERn_OFFSET*&SPMIOwnerChannel+&CHNLn_OFFSET*&SPMIChannel)
  )

  &data=DATA.LONG(&BusAccessMode:&PMIC_ARB_CHNLn_RDATA0+&OWNERn_OFFSET*&SPMIOwnerChannel+&CHNLn_OFFSET*&SPMIChannel)

  IF (&breakFlag==1)
  (
    g
  )

  RETURN &status &data


;=============================================================================
; SUB: SPMIWrite
;=============================================================================

SPMIWrite:

  ENTRY &RegisterAddress &SlaveId &Data

  &RegisterOffset=(&RegisterAddress)&0xFF
  &RegisterBase=((&RegisterAddress)&0xFF00)|(&SlaveId<<0x10)
  &RegisterOwner=(((&RegisterAddress<<0x8)&0xFF0000)|(&SlaveId<<0x8))|&SPMIOwnerChannel
  &SPMIChannel=&MAX_SPMI_CHANNELS
  &breakFlag=0

  IF (STATE.RUN()&&(SYSTEM.MODE()>0x5)&&("&BusAccessMode"=="A"))
  (
    &breakFlag=1
    b
    WAIT 1.ms
  )

  DATA.SET &BusAccessMode:&PMIC_ARB_CHNLn_ADDR+(4*&SPMIChannel) %LONG &RegisterBase

  DATA.SET &BusAccessMode:&PMIC_ARB_PERIPHn_OWNER_ADDR+(4*&SPMIChannel) %LONG &RegisterOwner

  DATA.SET &BusAccessMode:&PMIC_ARB_CHNLn_WDATA0+&OWNERn_OFFSET*&SPMIOwnerChannel+&CHNLn_OFFSET*&SPMIChannel %LONG (&Data&0xFF)

  &cmd=(0x0<<0x1B)|(&RegisterOffset<<0x4)

  DATA.SET &BusAccessMode:&PMIC_ARB_CHNLn_CMD+&OWNERn_OFFSET*&SPMIOwnerChannel+&CHNLn_OFFSET*&SPMIChannel %LONG &cmd

  &status=0
  WHILE (&status==0)
  (
    WAIT 1.ms
    &status=DATA.LONG(&BusAccessMode:&PMIC_ARB_CHNLn_STATUS+&OWNERn_OFFSET*&SPMIOwnerChannel+&CHNLn_OFFSET*&SPMIChannel)
  )

  IF (&breakFlag==1)
  (
    g
  )

  RETURN &status


