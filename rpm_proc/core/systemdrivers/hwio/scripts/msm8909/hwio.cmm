y.create.l HWIO_APCS_QTMR_AC_CNTFRQ_ADDR A:0x6b020000
y.create.l HWIO_APCS_QTMR_AC_CNTSR_ADDR A:0x6b020004
y.create.l HWIO_APCS_QTMR_AC_CNTTID_ADDR A:0x6b020008
y.create.l HWIO_APCS_QTMR_AC_CNTACR_0_ADDR A:0x6b020040
y.create.l HWIO_APCS_QTMR_AC_CNTACR_1_ADDR A:0x6b020044
y.create.l HWIO_APCS_QTMR_AC_CNTACR_2_ADDR A:0x6b020048
y.create.l HWIO_APCS_QTMR_AC_CNTACR_3_ADDR A:0x6b02004c
y.create.l HWIO_APCS_QTMR_AC_CNTACR_4_ADDR A:0x6b020050
y.create.l HWIO_APCS_QTMR_AC_CNTACR_5_ADDR A:0x6b020054
y.create.l HWIO_APCS_QTMR_AC_CNTACR_6_ADDR A:0x6b020058
y.create.l HWIO_APCS_QTMR_AC_CNTVOFF_LO_0_ADDR A:0x6b020080
y.create.l HWIO_APCS_QTMR_AC_CNTVOFF_LO_1_ADDR A:0x6b020088
y.create.l HWIO_APCS_QTMR_AC_CNTVOFF_LO_2_ADDR A:0x6b020090
y.create.l HWIO_APCS_QTMR_AC_CNTVOFF_LO_3_ADDR A:0x6b020098
y.create.l HWIO_APCS_QTMR_AC_CNTVOFF_LO_4_ADDR A:0x6b0200a0
y.create.l HWIO_APCS_QTMR_AC_CNTVOFF_LO_5_ADDR A:0x6b0200a8
y.create.l HWIO_APCS_QTMR_AC_CNTVOFF_LO_6_ADDR A:0x6b0200b0
y.create.l HWIO_APCS_QTMR_AC_CNTVOFF_HI_0_ADDR A:0x6b020084
y.create.l HWIO_APCS_QTMR_AC_CNTVOFF_HI_1_ADDR A:0x6b02008c
y.create.l HWIO_APCS_QTMR_AC_CNTVOFF_HI_2_ADDR A:0x6b020094
y.create.l HWIO_APCS_QTMR_AC_CNTVOFF_HI_3_ADDR A:0x6b02009c
y.create.l HWIO_APCS_QTMR_AC_CNTVOFF_HI_4_ADDR A:0x6b0200a4
y.create.l HWIO_APCS_QTMR_AC_CNTVOFF_HI_5_ADDR A:0x6b0200ac
y.create.l HWIO_APCS_QTMR_AC_CNTVOFF_HI_6_ADDR A:0x6b0200b4
y.create.l HWIO_APCS_QTMR_AC_CFG_ADDR A:0x6b020fc0
y.create.l HWIO_APCS_QTMR_AC_VERSION_ADDR A:0x6b020fd0
y.create.l HWIO_APCS_F0_QTMR_V1_CNTPCT_LO_ADDR A:0x6b021000
y.create.l HWIO_APCS_F0_QTMR_V1_CNTPCT_HI_ADDR A:0x6b021004
y.create.l HWIO_APCS_F0_QTMR_V1_CNTVCT_LO_ADDR A:0x6b021008
y.create.l HWIO_APCS_F0_QTMR_V1_CNTVCT_HI_ADDR A:0x6b02100c
y.create.l HWIO_APCS_F0_QTMR_V1_CNTFRQ_ADDR A:0x6b021010
y.create.l HWIO_APCS_F0_QTMR_V1_CNTPL0ACR_ADDR A:0x6b021014
y.create.l HWIO_APCS_F0_QTMR_V1_CNTVOFF_LO_ADDR A:0x6b021018
y.create.l HWIO_APCS_F0_QTMR_V1_CNTVOFF_HI_ADDR A:0x6b02101c
y.create.l HWIO_APCS_F0_QTMR_V1_CNTP_CVAL_LO_ADDR A:0x6b021020
y.create.l HWIO_APCS_F0_QTMR_V1_CNTP_CVAL_HI_ADDR A:0x6b021024
y.create.l HWIO_APCS_F0_QTMR_V1_CNTP_TVAL_ADDR A:0x6b021028
y.create.l HWIO_APCS_F0_QTMR_V1_CNTP_CTL_ADDR A:0x6b02102c
y.create.l HWIO_APCS_F0_QTMR_V1_CNTV_CVAL_LO_ADDR A:0x6b021030
y.create.l HWIO_APCS_F0_QTMR_V1_CNTV_CVAL_HI_ADDR A:0x6b021034
y.create.l HWIO_APCS_F0_QTMR_V1_CNTV_TVAL_ADDR A:0x6b021038
y.create.l HWIO_APCS_F0_QTMR_V1_CNTV_CTL_ADDR A:0x6b02103c
y.create.l HWIO_APCS_F0_QTMR_V1_VERSION_ADDR A:0x6b021fd0
y.create.l HWIO_APCS_F0_QTMR_V2_CNTPCT_LO_ADDR A:0x6b022000
y.create.l HWIO_APCS_F0_QTMR_V2_CNTPCT_HI_ADDR A:0x6b022004
y.create.l HWIO_APCS_F0_QTMR_V2_CNTVCT_LO_ADDR A:0x6b022008
y.create.l HWIO_APCS_F0_QTMR_V2_CNTVCT_HI_ADDR A:0x6b02200c
y.create.l HWIO_APCS_F0_QTMR_V2_CNTFRQ_ADDR A:0x6b022010
y.create.l HWIO_APCS_F0_QTMR_V2_CNTP_CVAL_LO_ADDR A:0x6b022020
y.create.l HWIO_APCS_F0_QTMR_V2_CNTP_CVAL_HI_ADDR A:0x6b022024
y.create.l HWIO_APCS_F0_QTMR_V2_CNTP_TVAL_ADDR A:0x6b022028
y.create.l HWIO_APCS_F0_QTMR_V2_CNTP_CTL_ADDR A:0x6b02202c
y.create.l HWIO_APCS_F0_QTMR_V2_CNTV_CVAL_LO_ADDR A:0x6b022030
y.create.l HWIO_APCS_F0_QTMR_V2_CNTV_CVAL_HI_ADDR A:0x6b022034
y.create.l HWIO_APCS_F0_QTMR_V2_CNTV_TVAL_ADDR A:0x6b022038
y.create.l HWIO_APCS_F0_QTMR_V2_CNTV_CTL_ADDR A:0x6b02203c
y.create.l HWIO_APCS_F0_QTMR_V2_VERSION_ADDR A:0x6b022fd0
y.create.l HWIO_APCS_F1_QTMR_V1_CNTPCT_LO_ADDR A:0x6b023000
y.create.l HWIO_APCS_F1_QTMR_V1_CNTPCT_HI_ADDR A:0x6b023004
y.create.l HWIO_APCS_F1_QTMR_V1_CNTVCT_LO_ADDR A:0x6b023008
y.create.l HWIO_APCS_F1_QTMR_V1_CNTVCT_HI_ADDR A:0x6b02300c
y.create.l HWIO_APCS_F1_QTMR_V1_CNTFRQ_ADDR A:0x6b023010
y.create.l HWIO_APCS_F1_QTMR_V1_CNTPL0ACR_ADDR A:0x6b023014
y.create.l HWIO_APCS_F1_QTMR_V1_CNTVOFF_LO_ADDR A:0x6b023018
y.create.l HWIO_APCS_F1_QTMR_V1_CNTVOFF_HI_ADDR A:0x6b02301c
y.create.l HWIO_APCS_F1_QTMR_V1_CNTP_CVAL_LO_ADDR A:0x6b023020
y.create.l HWIO_APCS_F1_QTMR_V1_CNTP_CVAL_HI_ADDR A:0x6b023024
y.create.l HWIO_APCS_F1_QTMR_V1_CNTP_TVAL_ADDR A:0x6b023028
y.create.l HWIO_APCS_F1_QTMR_V1_CNTP_CTL_ADDR A:0x6b02302c
y.create.l HWIO_APCS_F1_QTMR_V1_CNTV_CVAL_LO_ADDR A:0x6b023030
y.create.l HWIO_APCS_F1_QTMR_V1_CNTV_CVAL_HI_ADDR A:0x6b023034
y.create.l HWIO_APCS_F1_QTMR_V1_CNTV_TVAL_ADDR A:0x6b023038
y.create.l HWIO_APCS_F1_QTMR_V1_CNTV_CTL_ADDR A:0x6b02303c
y.create.l HWIO_APCS_F1_QTMR_V1_VERSION_ADDR A:0x6b023fd0
y.create.l HWIO_APCS_F2_QTMR_V1_CNTPCT_LO_ADDR A:0x6b024000
y.create.l HWIO_APCS_F2_QTMR_V1_CNTPCT_HI_ADDR A:0x6b024004
y.create.l HWIO_APCS_F2_QTMR_V1_CNTVCT_LO_ADDR A:0x6b024008
y.create.l HWIO_APCS_F2_QTMR_V1_CNTVCT_HI_ADDR A:0x6b02400c
y.create.l HWIO_APCS_F2_QTMR_V1_CNTFRQ_ADDR A:0x6b024010
y.create.l HWIO_APCS_F2_QTMR_V1_CNTPL0ACR_ADDR A:0x6b024014
y.create.l HWIO_APCS_F2_QTMR_V1_CNTVOFF_LO_ADDR A:0x6b024018
y.create.l HWIO_APCS_F2_QTMR_V1_CNTVOFF_HI_ADDR A:0x6b02401c
y.create.l HWIO_APCS_F2_QTMR_V1_CNTP_CVAL_LO_ADDR A:0x6b024020
y.create.l HWIO_APCS_F2_QTMR_V1_CNTP_CVAL_HI_ADDR A:0x6b024024
y.create.l HWIO_APCS_F2_QTMR_V1_CNTP_TVAL_ADDR A:0x6b024028
y.create.l HWIO_APCS_F2_QTMR_V1_CNTP_CTL_ADDR A:0x6b02402c
y.create.l HWIO_APCS_F2_QTMR_V1_CNTV_CVAL_LO_ADDR A:0x6b024030
y.create.l HWIO_APCS_F2_QTMR_V1_CNTV_CVAL_HI_ADDR A:0x6b024034
y.create.l HWIO_APCS_F2_QTMR_V1_CNTV_TVAL_ADDR A:0x6b024038
y.create.l HWIO_APCS_F2_QTMR_V1_CNTV_CTL_ADDR A:0x6b02403c
y.create.l HWIO_APCS_F2_QTMR_V1_VERSION_ADDR A:0x6b024fd0
y.create.l HWIO_APCS_F3_QTMR_V1_CNTPCT_LO_ADDR A:0x6b025000
y.create.l HWIO_APCS_F3_QTMR_V1_CNTPCT_HI_ADDR A:0x6b025004
y.create.l HWIO_APCS_F3_QTMR_V1_CNTVCT_LO_ADDR A:0x6b025008
y.create.l HWIO_APCS_F3_QTMR_V1_CNTVCT_HI_ADDR A:0x6b02500c
y.create.l HWIO_APCS_F3_QTMR_V1_CNTFRQ_ADDR A:0x6b025010
y.create.l HWIO_APCS_F3_QTMR_V1_CNTPL0ACR_ADDR A:0x6b025014
y.create.l HWIO_APCS_F3_QTMR_V1_CNTVOFF_LO_ADDR A:0x6b025018
y.create.l HWIO_APCS_F3_QTMR_V1_CNTVOFF_HI_ADDR A:0x6b02501c
y.create.l HWIO_APCS_F3_QTMR_V1_CNTP_CVAL_LO_ADDR A:0x6b025020
y.create.l HWIO_APCS_F3_QTMR_V1_CNTP_CVAL_HI_ADDR A:0x6b025024
y.create.l HWIO_APCS_F3_QTMR_V1_CNTP_TVAL_ADDR A:0x6b025028
y.create.l HWIO_APCS_F3_QTMR_V1_CNTP_CTL_ADDR A:0x6b02502c
y.create.l HWIO_APCS_F3_QTMR_V1_CNTV_CVAL_LO_ADDR A:0x6b025030
y.create.l HWIO_APCS_F3_QTMR_V1_CNTV_CVAL_HI_ADDR A:0x6b025034
y.create.l HWIO_APCS_F3_QTMR_V1_CNTV_TVAL_ADDR A:0x6b025038
y.create.l HWIO_APCS_F3_QTMR_V1_CNTV_CTL_ADDR A:0x6b02503c
y.create.l HWIO_APCS_F3_QTMR_V1_VERSION_ADDR A:0x6b025fd0
y.create.l HWIO_APCS_F4_QTMR_V1_CNTPCT_LO_ADDR A:0x6b026000
y.create.l HWIO_APCS_F4_QTMR_V1_CNTPCT_HI_ADDR A:0x6b026004
y.create.l HWIO_APCS_F4_QTMR_V1_CNTVCT_LO_ADDR A:0x6b026008
y.create.l HWIO_APCS_F4_QTMR_V1_CNTVCT_HI_ADDR A:0x6b02600c
y.create.l HWIO_APCS_F4_QTMR_V1_CNTFRQ_ADDR A:0x6b026010
y.create.l HWIO_APCS_F4_QTMR_V1_CNTPL0ACR_ADDR A:0x6b026014
y.create.l HWIO_APCS_F4_QTMR_V1_CNTVOFF_LO_ADDR A:0x6b026018
y.create.l HWIO_APCS_F4_QTMR_V1_CNTVOFF_HI_ADDR A:0x6b02601c
y.create.l HWIO_APCS_F4_QTMR_V1_CNTP_CVAL_LO_ADDR A:0x6b026020
y.create.l HWIO_APCS_F4_QTMR_V1_CNTP_CVAL_HI_ADDR A:0x6b026024
y.create.l HWIO_APCS_F4_QTMR_V1_CNTP_TVAL_ADDR A:0x6b026028
y.create.l HWIO_APCS_F4_QTMR_V1_CNTP_CTL_ADDR A:0x6b02602c
y.create.l HWIO_APCS_F4_QTMR_V1_CNTV_CVAL_LO_ADDR A:0x6b026030
y.create.l HWIO_APCS_F4_QTMR_V1_CNTV_CVAL_HI_ADDR A:0x6b026034
y.create.l HWIO_APCS_F4_QTMR_V1_CNTV_TVAL_ADDR A:0x6b026038
y.create.l HWIO_APCS_F4_QTMR_V1_CNTV_CTL_ADDR A:0x6b02603c
y.create.l HWIO_APCS_F4_QTMR_V1_VERSION_ADDR A:0x6b026fd0
y.create.l HWIO_APCS_F5_QTMR_V1_CNTPCT_LO_ADDR A:0x6b027000
y.create.l HWIO_APCS_F5_QTMR_V1_CNTPCT_HI_ADDR A:0x6b027004
y.create.l HWIO_APCS_F5_QTMR_V1_CNTVCT_LO_ADDR A:0x6b027008
y.create.l HWIO_APCS_F5_QTMR_V1_CNTVCT_HI_ADDR A:0x6b02700c
y.create.l HWIO_APCS_F5_QTMR_V1_CNTFRQ_ADDR A:0x6b027010
y.create.l HWIO_APCS_F5_QTMR_V1_CNTPL0ACR_ADDR A:0x6b027014
y.create.l HWIO_APCS_F5_QTMR_V1_CNTVOFF_LO_ADDR A:0x6b027018
y.create.l HWIO_APCS_F5_QTMR_V1_CNTVOFF_HI_ADDR A:0x6b02701c
y.create.l HWIO_APCS_F5_QTMR_V1_CNTP_CVAL_LO_ADDR A:0x6b027020
y.create.l HWIO_APCS_F5_QTMR_V1_CNTP_CVAL_HI_ADDR A:0x6b027024
y.create.l HWIO_APCS_F5_QTMR_V1_CNTP_TVAL_ADDR A:0x6b027028
y.create.l HWIO_APCS_F5_QTMR_V1_CNTP_CTL_ADDR A:0x6b02702c
y.create.l HWIO_APCS_F5_QTMR_V1_CNTV_CVAL_LO_ADDR A:0x6b027030
y.create.l HWIO_APCS_F5_QTMR_V1_CNTV_CVAL_HI_ADDR A:0x6b027034
y.create.l HWIO_APCS_F5_QTMR_V1_CNTV_TVAL_ADDR A:0x6b027038
y.create.l HWIO_APCS_F5_QTMR_V1_CNTV_CTL_ADDR A:0x6b02703c
y.create.l HWIO_APCS_F5_QTMR_V1_VERSION_ADDR A:0x6b027fd0
y.create.l HWIO_APCS_F6_QTMR_V1_CNTPCT_LO_ADDR A:0x6b028000
y.create.l HWIO_APCS_F6_QTMR_V1_CNTPCT_HI_ADDR A:0x6b028004
y.create.l HWIO_APCS_F6_QTMR_V1_CNTVCT_LO_ADDR A:0x6b028008
y.create.l HWIO_APCS_F6_QTMR_V1_CNTVCT_HI_ADDR A:0x6b02800c
y.create.l HWIO_APCS_F6_QTMR_V1_CNTFRQ_ADDR A:0x6b028010
y.create.l HWIO_APCS_F6_QTMR_V1_CNTPL0ACR_ADDR A:0x6b028014
y.create.l HWIO_APCS_F6_QTMR_V1_CNTVOFF_LO_ADDR A:0x6b028018
y.create.l HWIO_APCS_F6_QTMR_V1_CNTVOFF_HI_ADDR A:0x6b02801c
y.create.l HWIO_APCS_F6_QTMR_V1_CNTP_CVAL_LO_ADDR A:0x6b028020
y.create.l HWIO_APCS_F6_QTMR_V1_CNTP_CVAL_HI_ADDR A:0x6b028024
y.create.l HWIO_APCS_F6_QTMR_V1_CNTP_TVAL_ADDR A:0x6b028028
y.create.l HWIO_APCS_F6_QTMR_V1_CNTP_CTL_ADDR A:0x6b02802c
y.create.l HWIO_APCS_F6_QTMR_V1_CNTV_CVAL_LO_ADDR A:0x6b028030
y.create.l HWIO_APCS_F6_QTMR_V1_CNTV_CVAL_HI_ADDR A:0x6b028034
y.create.l HWIO_APCS_F6_QTMR_V1_CNTV_TVAL_ADDR A:0x6b028038
y.create.l HWIO_APCS_F6_QTMR_V1_CNTV_CTL_ADDR A:0x6b02803c
y.create.l HWIO_APCS_F6_QTMR_V1_VERSION_ADDR A:0x6b028fd0
y.create.l HWIO_APCS_VMM_IPC_INTERRUPT_ADDR A:0x6b01a004
y.create.l HWIO_APCS_L2_SPM_VOTE_HYP_ADDR A:0x6b01a010
y.create.l HWIO_APCS_BANKED_SPM_VOTE_HYP_ADDR A:0x6b01a020
y.create.l HWIO_APCS_ALIAS0_SPM_VOTE_HYP_ADDR A:0x6b01a030
y.create.l HWIO_APCS_ALIAS1_SPM_VOTE_HYP_ADDR A:0x6b01a034
y.create.l HWIO_APCS_ALIAS2_SPM_VOTE_HYP_ADDR A:0x6b01a038
y.create.l HWIO_APCS_ALIAS3_SPM_VOTE_HYP_ADDR A:0x6b01a03c
y.create.l HWIO_APCS_RBCPR_VERSION_ADDR A:0x6b018000
y.create.l HWIO_APCS_RBCPR_SENSOR_MASK0_ADDR A:0x6b018020
y.create.l HWIO_APCS_RBCPR_SENSOR_MASK1_ADDR A:0x6b018024
y.create.l HWIO_APCS_RBCPR_SENSOR_MASK2_ADDR A:0x6b018028
y.create.l HWIO_APCS_RBCPR_SENSOR_MASK3_ADDR A:0x6b01802c
y.create.l HWIO_APCS_RBCPR_SENSOR_BYPASS0_ADDR A:0x6b018030
y.create.l HWIO_APCS_RBCPR_SENSOR_BYPASS1_ADDR A:0x6b018034
y.create.l HWIO_APCS_RBCPR_SENSOR_BYPASS2_ADDR A:0x6b018038
y.create.l HWIO_APCS_RBCPR_SENSOR_BYPASS3_ADDR A:0x6b01803c
y.create.l HWIO_APCS_RBIF_PMIC_ADDR_ADDR A:0x6b018040
y.create.l HWIO_APCS_RBCPR_TIMER_INTERVAL_ADDR A:0x6b018044
y.create.l HWIO_APCS_RBIF_LIMIT_ADDR A:0x6b018048
y.create.l HWIO_APCS_RBIF_TIMER_ADJUST_ADDR A:0x6b01804c
y.create.l HWIO_APCS_RBCPR_GCNT_TARGET0_ADDR A:0x6b018060
y.create.l HWIO_APCS_RBCPR_GCNT_TARGET1_ADDR A:0x6b018064
y.create.l HWIO_APCS_RBCPR_GCNT_TARGET2_ADDR A:0x6b018068
y.create.l HWIO_APCS_RBCPR_GCNT_TARGET3_ADDR A:0x6b01806c
y.create.l HWIO_APCS_RBCPR_GCNT_TARGET4_ADDR A:0x6b018070
y.create.l HWIO_APCS_RBCPR_GCNT_TARGET5_ADDR A:0x6b018074
y.create.l HWIO_APCS_RBCPR_GCNT_TARGET6_ADDR A:0x6b018078
y.create.l HWIO_APCS_RBCPR_GCNT_TARGET7_ADDR A:0x6b01807c
y.create.l HWIO_APCS_RBCPR_STEP_QUOT_ADDR A:0x6b018080
y.create.l HWIO_APCS_RBCPR_CTL_ADDR A:0x6b018090
y.create.l HWIO_APCS_RBIF_SW_VLEVEL_ADDR A:0x6b018094
y.create.l HWIO_APCS_RBIF_CONT_ACK_CMD_ADDR A:0x6b018098
y.create.l HWIO_APCS_RBIF_CONT_NACK_CMD_ADDR A:0x6b01809c
y.create.l HWIO_APCS_RBCPR_RESULT_0_ADDR A:0x6b0180a0
y.create.l HWIO_APCS_RBCPR_RESULT_1_ADDR A:0x6b0180a4
y.create.l HWIO_APCS_RBIF_IRQ_EN_0_ADDR A:0x6b018100
y.create.l HWIO_APCS_RBIF_IRQ_EN_1_ADDR A:0x6b018104
y.create.l HWIO_APCS_RBIF_IRQ_EN_2_ADDR A:0x6b018108
y.create.l HWIO_APCS_RBIF_IRQ_CLEAR_ADDR A:0x6b018110
y.create.l HWIO_APCS_RBIF_IRQ_STATUS_ADDR A:0x6b018114
y.create.l HWIO_APCS_RBCPR_QUOT_AVG_ADDR A:0x6b018118
y.create.l HWIO_APCS_RBCPR_DEBUG0_ADDR A:0x6b01811c
y.create.l HWIO_APCS_RBCPR_DEBUG1_ADDR A:0x6b018120
y.create.l HWIO_APCS_RBCPR_DEBUG2_ADDR A:0x6b018124
y.create.l HWIO_APCS_RBCPR_BIST_MINMAX_ADDR A:0x6b018128
y.create.l HWIO_APCS_RBCPR_BIST_RESULT_ADDR A:0x6b01812c
y.create.l HWIO_APCS_RBCPR_BIST_FAIL_MAP0_ADDR A:0x6b018130
y.create.l HWIO_APCS_RBCPR_BIST_FAIL_MAP1_ADDR A:0x6b018134
y.create.l HWIO_APCS_RBCPR_BIST_FAIL_MAP2_ADDR A:0x6b018138
y.create.l HWIO_APCS_RBCPR_BIST_FAIL_MAP3_ADDR A:0x6b01813c
y.create.l HWIO_APCS_RBCPR_LOG_0_ADDR A:0x6b018140
y.create.l HWIO_APCS_RBCPR_LOG_1_ADDR A:0x6b018144
y.create.l HWIO_APCS_RBCPR_LOG_2_ADDR A:0x6b018148
y.create.l HWIO_APCS_RBCPR_LOG_3_ADDR A:0x6b01814c
y.create.l HWIO_APCS_RBCPR_LOG_4_ADDR A:0x6b018150
y.create.l HWIO_APCS_RBCPR_LOG_5_ADDR A:0x6b018154
y.create.l HWIO_APCS_RBCPR_LOG_6_ADDR A:0x6b018158
y.create.l HWIO_APCS_RBCPR_LOG_7_ADDR A:0x6b01815c
y.create.l HWIO_APCS_RBCPR_HTOL_AGE_ADDR A:0x6b018160
y.create.l HWIO_APCS_WDOG_SECURE_ADDR A:0x6b017000
y.create.l HWIO_APCS_WDOG_RESET_ADDR A:0x6b017004
y.create.l HWIO_APCS_WDOG_CTL_ADDR A:0x6b017008
y.create.l HWIO_APCS_WDOG_STATUS_ADDR A:0x6b01700c
y.create.l HWIO_APCS_WDOG_BARK_TIME_ADDR A:0x6b017010
y.create.l HWIO_APCS_WDOG_BITE_TIME_ADDR A:0x6b017014
y.create.l HWIO_APCS_WDOG_TEST_LOAD_STATUS_ADDR A:0x6b017018
y.create.l HWIO_APCS_WDOG_TEST_LOAD_ADDR A:0x6b01701c
y.create.l HWIO_APCS_WDOG_TEST_ADDR A:0x6b017020
y.create.l HWIO_APCS_SH_PLL_MODE_ADDR A:0x6b016000
y.create.l HWIO_APCS_SH_PLL_L_VAL_ADDR A:0x6b016004
y.create.l HWIO_APCS_SH_PLL_M_VAL_ADDR A:0x6b016008
y.create.l HWIO_APCS_SH_PLL_N_VAL_ADDR A:0x6b01600c
y.create.l HWIO_APCS_SH_PLL_USER_CTL_ADDR A:0x6b016010
y.create.l HWIO_APCS_SH_PLL_CONFIG_CTL_ADDR A:0x6b016014
y.create.l HWIO_APCS_SH_PLL_TEST_CTL_ADDR A:0x6b016018
y.create.l HWIO_APCS_SH_PLL_STATUS_ADDR A:0x6b01601c
y.create.l HWIO_APCS_SH_PLL_SECURE_ADDR A:0x6b016030
y.create.l HWIO_APCS_L2_SAW2_SECURE_ADDR A:0x6b012000
y.create.l HWIO_APCS_L2_SAW2_ID_ADDR A:0x6b012004
y.create.l HWIO_APCS_L2_SAW2_CFG_ADDR A:0x6b012008
y.create.l HWIO_APCS_L2_SAW2_SPM_STS_ADDR A:0x6b01200c
y.create.l HWIO_APCS_L2_SAW2_AVS_STS_ADDR A:0x6b012010
y.create.l HWIO_APCS_L2_SAW2_PMIC_STS_ADDR A:0x6b012014
y.create.l HWIO_APCS_L2_SAW2_RST_ADDR A:0x6b012018
y.create.l HWIO_APCS_L2_SAW2_VCTL_ADDR A:0x6b01201c
y.create.l HWIO_APCS_L2_SAW2_AVS_CTL_ADDR A:0x6b012020
y.create.l HWIO_APCS_L2_SAW2_AVS_LIMIT_ADDR A:0x6b012024
y.create.l HWIO_APCS_L2_SAW2_AVS_DLY_ADDR A:0x6b012028
y.create.l HWIO_APCS_L2_SAW2_AVS_HYSTERESIS_ADDR A:0x6b01202c
y.create.l HWIO_APCS_L2_SAW2_SPM_CTL_ADDR A:0x6b012030
y.create.l HWIO_APCS_L2_SAW2_SPM_DLY_ADDR A:0x6b012034
y.create.l HWIO_APCS_L2_SAW2_SPM_STS2_ADDR A:0x6b012038
y.create.l HWIO_APCS_L2_SAW2_SPM_SLP_SEQ_ENTRY_0_ADDR A:0x6b012400
y.create.l HWIO_APCS_L2_SAW2_SPM_SLP_SEQ_ENTRY_1_ADDR A:0x6b012404
y.create.l HWIO_APCS_L2_SAW2_SPM_SLP_SEQ_ENTRY_2_ADDR A:0x6b012408
y.create.l HWIO_APCS_L2_SAW2_SPM_SLP_SEQ_ENTRY_3_ADDR A:0x6b01240c
y.create.l HWIO_APCS_L2_SAW2_SPM_SLP_SEQ_ENTRY_4_ADDR A:0x6b012410
y.create.l HWIO_APCS_L2_SAW2_SPM_SLP_SEQ_ENTRY_5_ADDR A:0x6b012414
y.create.l HWIO_APCS_L2_SAW2_SPM_SLP_SEQ_ENTRY_6_ADDR A:0x6b012418
y.create.l HWIO_APCS_L2_SAW2_SPM_SLP_SEQ_ENTRY_7_ADDR A:0x6b01241c
y.create.l HWIO_APCS_L2_SAW2_SPM_SLP_SEQ_ENTRY_8_ADDR A:0x6b012420
y.create.l HWIO_APCS_L2_SAW2_SPM_SLP_SEQ_ENTRY_9_ADDR A:0x6b012424
y.create.l HWIO_APCS_L2_SAW2_SPM_PMIC_DATA_0_ADDR A:0x6b012040
y.create.l HWIO_APCS_L2_SAW2_SPM_PMIC_DATA_1_ADDR A:0x6b012044
y.create.l HWIO_APCS_L2_SAW2_SPM_PMIC_DATA_2_ADDR A:0x6b012048
y.create.l HWIO_APCS_L2_SAW2_SPM_PMIC_DATA_3_ADDR A:0x6b01204c
y.create.l HWIO_APCS_L2_SAW2_SPM_PMIC_DATA_4_ADDR A:0x6b012050
y.create.l HWIO_APCS_L2_SAW2_SPM_PMIC_DATA_5_ADDR A:0x6b012054
y.create.l HWIO_APCS_L2_SAW2_VERSION_ADDR A:0x6b012fd0
y.create.l HWIO_APCS_BANKED_SAW2_SECURE_ADDR A:0x6b009000
y.create.l HWIO_APCS_BANKED_SAW2_ID_ADDR A:0x6b009004
y.create.l HWIO_APCS_BANKED_SAW2_CFG_ADDR A:0x6b009008
y.create.l HWIO_APCS_BANKED_SAW2_SPM_STS_ADDR A:0x6b00900c
y.create.l HWIO_APCS_BANKED_SAW2_AVS_STS_ADDR A:0x6b009010
y.create.l HWIO_APCS_BANKED_SAW2_PMIC_STS_ADDR A:0x6b009014
y.create.l HWIO_APCS_BANKED_SAW2_RST_ADDR A:0x6b009018
y.create.l HWIO_APCS_BANKED_SAW2_SPM_CTL_ADDR A:0x6b009030
y.create.l HWIO_APCS_BANKED_SAW2_SPM_DLY_ADDR A:0x6b009034
y.create.l HWIO_APCS_BANKED_SAW2_SPM_STS2_ADDR A:0x6b009038
y.create.l HWIO_APCS_BANKED_SAW2_SPM_SLP_SEQ_ENTRY_0_ADDR A:0x6b009400
y.create.l HWIO_APCS_BANKED_SAW2_SPM_SLP_SEQ_ENTRY_1_ADDR A:0x6b009404
y.create.l HWIO_APCS_BANKED_SAW2_SPM_SLP_SEQ_ENTRY_2_ADDR A:0x6b009408
y.create.l HWIO_APCS_BANKED_SAW2_SPM_SLP_SEQ_ENTRY_3_ADDR A:0x6b00940c
y.create.l HWIO_APCS_BANKED_SAW2_SPM_SLP_SEQ_ENTRY_4_ADDR A:0x6b009410
y.create.l HWIO_APCS_BANKED_SAW2_SPM_SLP_SEQ_ENTRY_5_ADDR A:0x6b009414
y.create.l HWIO_APCS_BANKED_SAW2_SPM_SLP_SEQ_ENTRY_6_ADDR A:0x6b009418
y.create.l HWIO_APCS_BANKED_SAW2_SPM_SLP_SEQ_ENTRY_7_ADDR A:0x6b00941c
y.create.l HWIO_APCS_BANKED_SAW2_SPM_SLP_SEQ_ENTRY_8_ADDR A:0x6b009420
y.create.l HWIO_APCS_BANKED_SAW2_SPM_SLP_SEQ_ENTRY_9_ADDR A:0x6b009424
y.create.l HWIO_APCS_BANKED_SAW2_VERSION_ADDR A:0x6b009fd0
y.create.l HWIO_APCS_ALIAS0_SAW2_SECURE_ADDR A:0x6b089000
y.create.l HWIO_APCS_ALIAS0_SAW2_ID_ADDR A:0x6b089004
y.create.l HWIO_APCS_ALIAS0_SAW2_CFG_ADDR A:0x6b089008
y.create.l HWIO_APCS_ALIAS0_SAW2_SPM_STS_ADDR A:0x6b08900c
y.create.l HWIO_APCS_ALIAS0_SAW2_AVS_STS_ADDR A:0x6b089010
y.create.l HWIO_APCS_ALIAS0_SAW2_PMIC_STS_ADDR A:0x6b089014
y.create.l HWIO_APCS_ALIAS0_SAW2_RST_ADDR A:0x6b089018
y.create.l HWIO_APCS_ALIAS0_SAW2_SPM_CTL_ADDR A:0x6b089030
y.create.l HWIO_APCS_ALIAS0_SAW2_SPM_DLY_ADDR A:0x6b089034
y.create.l HWIO_APCS_ALIAS0_SAW2_SPM_STS2_ADDR A:0x6b089038
y.create.l HWIO_APCS_ALIAS0_SAW2_SPM_SLP_SEQ_ENTRY_0_ADDR A:0x6b089400
y.create.l HWIO_APCS_ALIAS0_SAW2_SPM_SLP_SEQ_ENTRY_1_ADDR A:0x6b089404
y.create.l HWIO_APCS_ALIAS0_SAW2_SPM_SLP_SEQ_ENTRY_2_ADDR A:0x6b089408
y.create.l HWIO_APCS_ALIAS0_SAW2_SPM_SLP_SEQ_ENTRY_3_ADDR A:0x6b08940c
y.create.l HWIO_APCS_ALIAS0_SAW2_SPM_SLP_SEQ_ENTRY_4_ADDR A:0x6b089410
y.create.l HWIO_APCS_ALIAS0_SAW2_SPM_SLP_SEQ_ENTRY_5_ADDR A:0x6b089414
y.create.l HWIO_APCS_ALIAS0_SAW2_SPM_SLP_SEQ_ENTRY_6_ADDR A:0x6b089418
y.create.l HWIO_APCS_ALIAS0_SAW2_SPM_SLP_SEQ_ENTRY_7_ADDR A:0x6b08941c
y.create.l HWIO_APCS_ALIAS0_SAW2_SPM_SLP_SEQ_ENTRY_8_ADDR A:0x6b089420
y.create.l HWIO_APCS_ALIAS0_SAW2_SPM_SLP_SEQ_ENTRY_9_ADDR A:0x6b089424
y.create.l HWIO_APCS_ALIAS0_SAW2_VERSION_ADDR A:0x6b089fd0
y.create.l HWIO_APCS_ALIAS1_SAW2_SECURE_ADDR A:0x6b099000
y.create.l HWIO_APCS_ALIAS1_SAW2_ID_ADDR A:0x6b099004
y.create.l HWIO_APCS_ALIAS1_SAW2_CFG_ADDR A:0x6b099008
y.create.l HWIO_APCS_ALIAS1_SAW2_SPM_STS_ADDR A:0x6b09900c
y.create.l HWIO_APCS_ALIAS1_SAW2_AVS_STS_ADDR A:0x6b099010
y.create.l HWIO_APCS_ALIAS1_SAW2_PMIC_STS_ADDR A:0x6b099014
y.create.l HWIO_APCS_ALIAS1_SAW2_RST_ADDR A:0x6b099018
y.create.l HWIO_APCS_ALIAS1_SAW2_SPM_CTL_ADDR A:0x6b099030
y.create.l HWIO_APCS_ALIAS1_SAW2_SPM_DLY_ADDR A:0x6b099034
y.create.l HWIO_APCS_ALIAS1_SAW2_SPM_STS2_ADDR A:0x6b099038
y.create.l HWIO_APCS_ALIAS1_SAW2_SPM_SLP_SEQ_ENTRY_0_ADDR A:0x6b099400
y.create.l HWIO_APCS_ALIAS1_SAW2_SPM_SLP_SEQ_ENTRY_1_ADDR A:0x6b099404
y.create.l HWIO_APCS_ALIAS1_SAW2_SPM_SLP_SEQ_ENTRY_2_ADDR A:0x6b099408
y.create.l HWIO_APCS_ALIAS1_SAW2_SPM_SLP_SEQ_ENTRY_3_ADDR A:0x6b09940c
y.create.l HWIO_APCS_ALIAS1_SAW2_SPM_SLP_SEQ_ENTRY_4_ADDR A:0x6b099410
y.create.l HWIO_APCS_ALIAS1_SAW2_SPM_SLP_SEQ_ENTRY_5_ADDR A:0x6b099414
y.create.l HWIO_APCS_ALIAS1_SAW2_SPM_SLP_SEQ_ENTRY_6_ADDR A:0x6b099418
y.create.l HWIO_APCS_ALIAS1_SAW2_SPM_SLP_SEQ_ENTRY_7_ADDR A:0x6b09941c
y.create.l HWIO_APCS_ALIAS1_SAW2_SPM_SLP_SEQ_ENTRY_8_ADDR A:0x6b099420
y.create.l HWIO_APCS_ALIAS1_SAW2_SPM_SLP_SEQ_ENTRY_9_ADDR A:0x6b099424
y.create.l HWIO_APCS_ALIAS1_SAW2_VERSION_ADDR A:0x6b099fd0
y.create.l HWIO_APCS_ALIAS2_SAW2_SECURE_ADDR A:0x6b0a9000
y.create.l HWIO_APCS_ALIAS2_SAW2_ID_ADDR A:0x6b0a9004
y.create.l HWIO_APCS_ALIAS2_SAW2_CFG_ADDR A:0x6b0a9008
y.create.l HWIO_APCS_ALIAS2_SAW2_SPM_STS_ADDR A:0x6b0a900c
y.create.l HWIO_APCS_ALIAS2_SAW2_AVS_STS_ADDR A:0x6b0a9010
y.create.l HWIO_APCS_ALIAS2_SAW2_PMIC_STS_ADDR A:0x6b0a9014
y.create.l HWIO_APCS_ALIAS2_SAW2_RST_ADDR A:0x6b0a9018
y.create.l HWIO_APCS_ALIAS2_SAW2_SPM_CTL_ADDR A:0x6b0a9030
y.create.l HWIO_APCS_ALIAS2_SAW2_SPM_DLY_ADDR A:0x6b0a9034
y.create.l HWIO_APCS_ALIAS2_SAW2_SPM_STS2_ADDR A:0x6b0a9038
y.create.l HWIO_APCS_ALIAS2_SAW2_SPM_SLP_SEQ_ENTRY_0_ADDR A:0x6b0a9400
y.create.l HWIO_APCS_ALIAS2_SAW2_SPM_SLP_SEQ_ENTRY_1_ADDR A:0x6b0a9404
y.create.l HWIO_APCS_ALIAS2_SAW2_SPM_SLP_SEQ_ENTRY_2_ADDR A:0x6b0a9408
y.create.l HWIO_APCS_ALIAS2_SAW2_SPM_SLP_SEQ_ENTRY_3_ADDR A:0x6b0a940c
y.create.l HWIO_APCS_ALIAS2_SAW2_SPM_SLP_SEQ_ENTRY_4_ADDR A:0x6b0a9410
y.create.l HWIO_APCS_ALIAS2_SAW2_SPM_SLP_SEQ_ENTRY_5_ADDR A:0x6b0a9414
y.create.l HWIO_APCS_ALIAS2_SAW2_SPM_SLP_SEQ_ENTRY_6_ADDR A:0x6b0a9418
y.create.l HWIO_APCS_ALIAS2_SAW2_SPM_SLP_SEQ_ENTRY_7_ADDR A:0x6b0a941c
y.create.l HWIO_APCS_ALIAS2_SAW2_SPM_SLP_SEQ_ENTRY_8_ADDR A:0x6b0a9420
y.create.l HWIO_APCS_ALIAS2_SAW2_SPM_SLP_SEQ_ENTRY_9_ADDR A:0x6b0a9424
y.create.l HWIO_APCS_ALIAS2_SAW2_VERSION_ADDR A:0x6b0a9fd0
y.create.l HWIO_APCS_ALIAS3_SAW2_SECURE_ADDR A:0x6b0b9000
y.create.l HWIO_APCS_ALIAS3_SAW2_ID_ADDR A:0x6b0b9004
y.create.l HWIO_APCS_ALIAS3_SAW2_CFG_ADDR A:0x6b0b9008
y.create.l HWIO_APCS_ALIAS3_SAW2_SPM_STS_ADDR A:0x6b0b900c
y.create.l HWIO_APCS_ALIAS3_SAW2_AVS_STS_ADDR A:0x6b0b9010
y.create.l HWIO_APCS_ALIAS3_SAW2_PMIC_STS_ADDR A:0x6b0b9014
y.create.l HWIO_APCS_ALIAS3_SAW2_RST_ADDR A:0x6b0b9018
y.create.l HWIO_APCS_ALIAS3_SAW2_SPM_CTL_ADDR A:0x6b0b9030
y.create.l HWIO_APCS_ALIAS3_SAW2_SPM_DLY_ADDR A:0x6b0b9034
y.create.l HWIO_APCS_ALIAS3_SAW2_SPM_STS2_ADDR A:0x6b0b9038
y.create.l HWIO_APCS_ALIAS3_SAW2_SPM_SLP_SEQ_ENTRY_0_ADDR A:0x6b0b9400
y.create.l HWIO_APCS_ALIAS3_SAW2_SPM_SLP_SEQ_ENTRY_1_ADDR A:0x6b0b9404
y.create.l HWIO_APCS_ALIAS3_SAW2_SPM_SLP_SEQ_ENTRY_2_ADDR A:0x6b0b9408
y.create.l HWIO_APCS_ALIAS3_SAW2_SPM_SLP_SEQ_ENTRY_3_ADDR A:0x6b0b940c
y.create.l HWIO_APCS_ALIAS3_SAW2_SPM_SLP_SEQ_ENTRY_4_ADDR A:0x6b0b9410
y.create.l HWIO_APCS_ALIAS3_SAW2_SPM_SLP_SEQ_ENTRY_5_ADDR A:0x6b0b9414
y.create.l HWIO_APCS_ALIAS3_SAW2_SPM_SLP_SEQ_ENTRY_6_ADDR A:0x6b0b9418
y.create.l HWIO_APCS_ALIAS3_SAW2_SPM_SLP_SEQ_ENTRY_7_ADDR A:0x6b0b941c
y.create.l HWIO_APCS_ALIAS3_SAW2_SPM_SLP_SEQ_ENTRY_8_ADDR A:0x6b0b9420
y.create.l HWIO_APCS_ALIAS3_SAW2_SPM_SLP_SEQ_ENTRY_9_ADDR A:0x6b0b9424
y.create.l HWIO_APCS_ALIAS3_SAW2_VERSION_ADDR A:0x6b0b9fd0
y.create.l HWIO_APCS_GLB_SECURE_ADDR A:0x6b011000
y.create.l HWIO_APCS_TZ_IPC_INTERRUPT_ADDR A:0x6b011004
y.create.l HWIO_APCS_IPC_INTERRUPT_ADDR A:0x6b011008
y.create.l HWIO_APCS_PWR_CTL_OVERRIDE_ADDR A:0x6b01100c
y.create.l HWIO_APCS_GLB_CLK_STATUS_ADDR A:0x6b011010
y.create.l HWIO_APCS_L2_PWR_CTL_ADDR A:0x6b011014
y.create.l HWIO_APCS_L2_PWR_STATUS_ADDR A:0x6b011018
y.create.l HWIO_APCS_GLB_CLK_DIAG_ADDR A:0x6b01101c
y.create.l HWIO_APCS_GLB_TEST_BUS_SEL_ADDR A:0x6b011020
y.create.l HWIO_APCS_DBG_PWR_CTL_ADDR A:0x6b011024
y.create.l HWIO_APCS_GLB_SPARE_ADDR A:0x6b011028
y.create.l HWIO_APCS_SPARE_STATUS_ADDR A:0x6b01102c
y.create.l HWIO_APCS_IDR_ADDR A:0x6b011030
y.create.l HWIO_APCS_XO_CBCR_ADDR A:0x6b011034
y.create.l HWIO_APCS_SLEEP_CBCR_ADDR A:0x6b011038
y.create.l HWIO_APCS_CMD_RCGR_ADDR A:0x6b011050
y.create.l HWIO_APCS_CFG_RCGR_ADDR A:0x6b011054
y.create.l HWIO_APCS_CORE_CBCR_ADDR A:0x6b011058
y.create.l HWIO_APCS_RBCPR_BCR_ADDR A:0x6b011060
y.create.l HWIO_APCS_RBCPR_CLK_SEL_ADDR A:0x6b011064
y.create.l HWIO_APCS_RBCPR_PMIC_ADDR A:0x6b011068
y.create.l HWIO_APCS_A7_CFG_STS_ADDR A:0x6b01106c
y.create.l HWIO_APCS_AUX_CLK_ON_ADDR A:0x6b011074
y.create.l HWIO_APCS_QSB_LP_ADDR A:0x6b011078
y.create.l HWIO_APCS_APPS_BOOTFSM_CTL_ADDR A:0x6b011100
y.create.l HWIO_APCS_APPS_BOOTFSM_STATUS_ADDR A:0x6b011104
y.create.l HWIO_APCS_L2_SPM_AUX_STARTADDR_ADDR A:0x6b011110
y.create.l HWIO_APCS_L2_SPM_VOTE_TZ_ADDR A:0x6b011200
y.create.l HWIO_APCS_L2_SPM_VOTE_HLOS_ADDR A:0x6b011204
y.create.l HWIO_APCS_L2_SPM_VOTE_INT_STATUS_ADDR A:0x6b011208
y.create.l HWIO_APCS_L2_SPM_VOTE_INT_CLEAR_ADDR A:0x6b01120c
y.create.l HWIO_APCS_L2_SPM_FORCE_EVENT_EN_ADDR A:0x6b011250
y.create.l HWIO_APCS_L2_SPM_FORCE_EVENT_ADDR A:0x6b011254
y.create.l HWIO_APCS_L2_SPM_FORCE_PWR_CTL_EN_ADDR A:0x6b011258
y.create.l HWIO_APCS_L2_SPM_FORCE_PWR_CTL_ADDR A:0x6b01125c
y.create.l HWIO_APCS_L2_SPM_EVENT_STS_ADDR A:0x6b011260
y.create.l HWIO_APCS_L2_SPM_PWR_CTL_STS_ADDR A:0x6b011264
y.create.l HWIO_APCS_S1LM_SEC_DIVIDER_DIV_VALUE_ADDR A:0x6b011300
y.create.l HWIO_APCS_CORE_ARST_APCNSAW_ADDR A:0x6b011304
y.create.l HWIO_APCS_VERSION_ADDR A:0x6b011fd0
y.create.l HWIO_APCS_CFG_SECURE_ADDR A:0x6b010000
y.create.l HWIO_APCS_START_ADDR_SEC_ADDR A:0x6b010004
y.create.l HWIO_APCS_START_ADDR_NSEC_ADDR A:0x6b010008
y.create.l HWIO_APCS_TCM_START_ADDR_ADDR A:0x6b010010
y.create.l HWIO_APCS_BANKED_APC_SECURE_ADDR A:0x6b008000
y.create.l HWIO_APCS_BANKED_CPU_PWR_CTL_ADDR A:0x6b008004
y.create.l HWIO_APCS_BANKED_APC_A7_CFG_STS_ADDR A:0x6b008040
y.create.l HWIO_APCS_BANKED_APC_PWR_STATUS_ADDR A:0x6b008008
y.create.l HWIO_APCS_BANKED_APC_TEST_BUS_SEL_ADDR A:0x6b00800c
y.create.l HWIO_APCS_BANKED_CPU_TRGTD_DBG_RST_ADDR A:0x6b008010
y.create.l HWIO_APCS_BANKED_APC_PWR_GATE_CTL_ADDR A:0x6b008014
y.create.l HWIO_APCS_BANKED_APC_PWR_GATE_STATUS_ADDR A:0x6b008030
y.create.l HWIO_APCS_BANKED_SPM_AUX_STARTADDR_ADDR A:0x6b008044
y.create.l HWIO_APCS_BANKED_SPM_VOTE_TZ_ADDR A:0x6b008050
y.create.l HWIO_APCS_BANKED_SPM_VOTE_HLOS_ADDR A:0x6b008054
y.create.l HWIO_APCS_BANKED_SPM_VOTE_INT_STATUS_ADDR A:0x6b008058
y.create.l HWIO_APCS_BANKED_SPM_VOTE_INT_CLEAR_ADDR A:0x6b00805c
y.create.l HWIO_APCS_BANKED_GCC_DBG_CLK_ON_REQ_ADDR A:0x6b008060
y.create.l HWIO_APCS_BANKED_SPM_FORCE_EVENT_EN_ADDR A:0x6b008070
y.create.l HWIO_APCS_BANKED_SPM_FORCE_EVENT_ADDR A:0x6b008074
y.create.l HWIO_APCS_BANKED_SPM_FORCE_PWR_CTL_EN_ADDR A:0x6b008078
y.create.l HWIO_APCS_BANKED_SPM_FORCE_PWR_CTL_ADDR A:0x6b00807c
y.create.l HWIO_APCS_BANKED_SPM_EVENT_STS_ADDR A:0x6b008080
y.create.l HWIO_APCS_BANKED_SPM_PWR_CTL_STS_ADDR A:0x6b008084
y.create.l HWIO_APCS_ALIAS0_APC_SECURE_ADDR A:0x6b088000
y.create.l HWIO_APCS_ALIAS0_CPU_PWR_CTL_ADDR A:0x6b088004
y.create.l HWIO_APCS_ALIAS0_APC_A7_CFG_STS_ADDR A:0x6b088040
y.create.l HWIO_APCS_ALIAS0_APC_PWR_STATUS_ADDR A:0x6b088008
y.create.l HWIO_APCS_ALIAS0_APC_TEST_BUS_SEL_ADDR A:0x6b08800c
y.create.l HWIO_APCS_ALIAS0_CPU_TRGTD_DBG_RST_ADDR A:0x6b088010
y.create.l HWIO_APCS_ALIAS0_APC_PWR_GATE_CTL_ADDR A:0x6b088014
y.create.l HWIO_APCS_ALIAS0_APC_PWR_GATE_STATUS_ADDR A:0x6b088030
y.create.l HWIO_APCS_ALIAS0_SPM_AUX_STARTADDR_ADDR A:0x6b088044
y.create.l HWIO_APCS_ALIAS0_SPM_VOTE_TZ_ADDR A:0x6b088050
y.create.l HWIO_APCS_ALIAS0_SPM_VOTE_HLOS_ADDR A:0x6b088054
y.create.l HWIO_APCS_ALIAS0_SPM_VOTE_INT_STATUS_ADDR A:0x6b088058
y.create.l HWIO_APCS_ALIAS0_SPM_VOTE_INT_CLEAR_ADDR A:0x6b08805c
y.create.l HWIO_APCS_ALIAS0_GCC_DBG_CLK_ON_REQ_ADDR A:0x6b088060
y.create.l HWIO_APCS_ALIAS0_SPM_FORCE_EVENT_EN_ADDR A:0x6b088070
y.create.l HWIO_APCS_ALIAS0_SPM_FORCE_EVENT_ADDR A:0x6b088074
y.create.l HWIO_APCS_ALIAS0_SPM_FORCE_PWR_CTL_EN_ADDR A:0x6b088078
y.create.l HWIO_APCS_ALIAS0_SPM_FORCE_PWR_CTL_ADDR A:0x6b08807c
y.create.l HWIO_APCS_ALIAS0_SPM_EVENT_STS_ADDR A:0x6b088080
y.create.l HWIO_APCS_ALIAS0_SPM_PWR_CTL_STS_ADDR A:0x6b088084
y.create.l HWIO_APCS_ALIAS1_APC_SECURE_ADDR A:0x6b098000
y.create.l HWIO_APCS_ALIAS1_CPU_PWR_CTL_ADDR A:0x6b098004
y.create.l HWIO_APCS_ALIAS1_APC_A7_CFG_STS_ADDR A:0x6b098040
y.create.l HWIO_APCS_ALIAS1_APC_PWR_STATUS_ADDR A:0x6b098008
y.create.l HWIO_APCS_ALIAS1_APC_TEST_BUS_SEL_ADDR A:0x6b09800c
y.create.l HWIO_APCS_ALIAS1_CPU_TRGTD_DBG_RST_ADDR A:0x6b098010
y.create.l HWIO_APCS_ALIAS1_APC_PWR_GATE_CTL_ADDR A:0x6b098014
y.create.l HWIO_APCS_ALIAS1_APC_PWR_GATE_STATUS_ADDR A:0x6b098030
y.create.l HWIO_APCS_ALIAS1_SPM_AUX_STARTADDR_ADDR A:0x6b098044
y.create.l HWIO_APCS_ALIAS1_SPM_VOTE_TZ_ADDR A:0x6b098050
y.create.l HWIO_APCS_ALIAS1_SPM_VOTE_HLOS_ADDR A:0x6b098054
y.create.l HWIO_APCS_ALIAS1_SPM_VOTE_INT_STATUS_ADDR A:0x6b098058
y.create.l HWIO_APCS_ALIAS1_SPM_VOTE_INT_CLEAR_ADDR A:0x6b09805c
y.create.l HWIO_APCS_ALIAS1_GCC_DBG_CLK_ON_REQ_ADDR A:0x6b098060
y.create.l HWIO_APCS_ALIAS1_SPM_FORCE_EVENT_EN_ADDR A:0x6b098070
y.create.l HWIO_APCS_ALIAS1_SPM_FORCE_EVENT_ADDR A:0x6b098074
y.create.l HWIO_APCS_ALIAS1_SPM_FORCE_PWR_CTL_EN_ADDR A:0x6b098078
y.create.l HWIO_APCS_ALIAS1_SPM_FORCE_PWR_CTL_ADDR A:0x6b09807c
y.create.l HWIO_APCS_ALIAS1_SPM_EVENT_STS_ADDR A:0x6b098080
y.create.l HWIO_APCS_ALIAS1_SPM_PWR_CTL_STS_ADDR A:0x6b098084
y.create.l HWIO_APCS_ALIAS2_APC_SECURE_ADDR A:0x6b0a8000
y.create.l HWIO_APCS_ALIAS2_CPU_PWR_CTL_ADDR A:0x6b0a8004
y.create.l HWIO_APCS_ALIAS2_APC_A7_CFG_STS_ADDR A:0x6b0a8040
y.create.l HWIO_APCS_ALIAS2_APC_PWR_STATUS_ADDR A:0x6b0a8008
y.create.l HWIO_APCS_ALIAS2_APC_TEST_BUS_SEL_ADDR A:0x6b0a800c
y.create.l HWIO_APCS_ALIAS2_CPU_TRGTD_DBG_RST_ADDR A:0x6b0a8010
y.create.l HWIO_APCS_ALIAS2_APC_PWR_GATE_CTL_ADDR A:0x6b0a8014
y.create.l HWIO_APCS_ALIAS2_APC_PWR_GATE_STATUS_ADDR A:0x6b0a8030
y.create.l HWIO_APCS_ALIAS2_SPM_AUX_STARTADDR_ADDR A:0x6b0a8044
y.create.l HWIO_APCS_ALIAS2_SPM_VOTE_TZ_ADDR A:0x6b0a8050
y.create.l HWIO_APCS_ALIAS2_SPM_VOTE_HLOS_ADDR A:0x6b0a8054
y.create.l HWIO_APCS_ALIAS2_SPM_VOTE_INT_STATUS_ADDR A:0x6b0a8058
y.create.l HWIO_APCS_ALIAS2_SPM_VOTE_INT_CLEAR_ADDR A:0x6b0a805c
y.create.l HWIO_APCS_ALIAS2_GCC_DBG_CLK_ON_REQ_ADDR A:0x6b0a8060
y.create.l HWIO_APCS_ALIAS2_SPM_FORCE_EVENT_EN_ADDR A:0x6b0a8070
y.create.l HWIO_APCS_ALIAS2_SPM_FORCE_EVENT_ADDR A:0x6b0a8074
y.create.l HWIO_APCS_ALIAS2_SPM_FORCE_PWR_CTL_EN_ADDR A:0x6b0a8078
y.create.l HWIO_APCS_ALIAS2_SPM_FORCE_PWR_CTL_ADDR A:0x6b0a807c
y.create.l HWIO_APCS_ALIAS2_SPM_EVENT_STS_ADDR A:0x6b0a8080
y.create.l HWIO_APCS_ALIAS2_SPM_PWR_CTL_STS_ADDR A:0x6b0a8084
y.create.l HWIO_APCS_ALIAS3_APC_SECURE_ADDR A:0x6b0b8000
y.create.l HWIO_APCS_ALIAS3_CPU_PWR_CTL_ADDR A:0x6b0b8004
y.create.l HWIO_APCS_ALIAS3_APC_A7_CFG_STS_ADDR A:0x6b0b8040
y.create.l HWIO_APCS_ALIAS3_APC_PWR_STATUS_ADDR A:0x6b0b8008
y.create.l HWIO_APCS_ALIAS3_APC_TEST_BUS_SEL_ADDR A:0x6b0b800c
y.create.l HWIO_APCS_ALIAS3_CPU_TRGTD_DBG_RST_ADDR A:0x6b0b8010
y.create.l HWIO_APCS_ALIAS3_APC_PWR_GATE_CTL_ADDR A:0x6b0b8014
y.create.l HWIO_APCS_ALIAS3_APC_PWR_GATE_STATUS_ADDR A:0x6b0b8030
y.create.l HWIO_APCS_ALIAS3_SPM_AUX_STARTADDR_ADDR A:0x6b0b8044
y.create.l HWIO_APCS_ALIAS3_SPM_VOTE_TZ_ADDR A:0x6b0b8050
y.create.l HWIO_APCS_ALIAS3_SPM_VOTE_HLOS_ADDR A:0x6b0b8054
y.create.l HWIO_APCS_ALIAS3_SPM_VOTE_INT_STATUS_ADDR A:0x6b0b8058
y.create.l HWIO_APCS_ALIAS3_SPM_VOTE_INT_CLEAR_ADDR A:0x6b0b805c
y.create.l HWIO_APCS_ALIAS3_GCC_DBG_CLK_ON_REQ_ADDR A:0x6b0b8060
y.create.l HWIO_APCS_ALIAS3_SPM_FORCE_EVENT_EN_ADDR A:0x6b0b8070
y.create.l HWIO_APCS_ALIAS3_SPM_FORCE_EVENT_ADDR A:0x6b0b8074
y.create.l HWIO_APCS_ALIAS3_SPM_FORCE_PWR_CTL_EN_ADDR A:0x6b0b8078
y.create.l HWIO_APCS_ALIAS3_SPM_FORCE_PWR_CTL_ADDR A:0x6b0b807c
y.create.l HWIO_APCS_ALIAS3_SPM_EVENT_STS_ADDR A:0x6b0b8080
y.create.l HWIO_APCS_ALIAS3_SPM_PWR_CTL_STS_ADDR A:0x6b0b8084
y.create.l HWIO_APCS_GICD_CTLR_ADDR A:0x6b000000
y.create.l HWIO_APCS_GICD_TYPER_ADDR A:0x6b000004
y.create.l HWIO_APCS_GICD_IIDR_ADDR A:0x6b000008
y.create.l HWIO_APCS_GICD_ANSACR_ADDR A:0x6b000020
y.create.l HWIO_APCS_GICD_CGCR_ADDR A:0x6b000024
y.create.l HWIO_APCS_GICD_HW_VERSION_ADDR A:0x6b000030
y.create.l HWIO_APCS_GICD_ISR0_ADDR A:0x6b000080
y.create.l HWIO_APCS_GICD_ISR1_ADDR A:0x6b000084
y.create.l HWIO_APCS_GICD_ISR2_ADDR A:0x6b000088
y.create.l HWIO_APCS_GICD_ISR3_ADDR A:0x6b00008c
y.create.l HWIO_APCS_GICD_ISR4_ADDR A:0x6b000090
y.create.l HWIO_APCS_GICD_ISR5_ADDR A:0x6b000094
y.create.l HWIO_APCS_GICD_ISR6_ADDR A:0x6b000098
y.create.l HWIO_APCS_GICD_ISR7_ADDR A:0x6b00009c
y.create.l HWIO_APCS_GICD_ISR8_ADDR A:0x6b0000a0
y.create.l HWIO_APCS_GICD_ISENABLER0_ADDR A:0x6b000100
y.create.l HWIO_APCS_GICD_ISENABLER1_ADDR A:0x6b000104
y.create.l HWIO_APCS_GICD_ISENABLER2_ADDR A:0x6b000108
y.create.l HWIO_APCS_GICD_ISENABLER3_ADDR A:0x6b00010c
y.create.l HWIO_APCS_GICD_ISENABLER4_ADDR A:0x6b000110
y.create.l HWIO_APCS_GICD_ISENABLER5_ADDR A:0x6b000114
y.create.l HWIO_APCS_GICD_ISENABLER6_ADDR A:0x6b000118
y.create.l HWIO_APCS_GICD_ISENABLER7_ADDR A:0x6b00011c
y.create.l HWIO_APCS_GICD_ISENABLER8_ADDR A:0x6b000120
y.create.l HWIO_APCS_GICD_ICENABLER0_ADDR A:0x6b000180
y.create.l HWIO_APCS_GICD_ICENABLER1_ADDR A:0x6b000184
y.create.l HWIO_APCS_GICD_ICENABLER2_ADDR A:0x6b000188
y.create.l HWIO_APCS_GICD_ICENABLER3_ADDR A:0x6b00018c
y.create.l HWIO_APCS_GICD_ICENABLER4_ADDR A:0x6b000190
y.create.l HWIO_APCS_GICD_ICENABLER5_ADDR A:0x6b000194
y.create.l HWIO_APCS_GICD_ICENABLER6_ADDR A:0x6b000198
y.create.l HWIO_APCS_GICD_ICENABLER7_ADDR A:0x6b00019c
y.create.l HWIO_APCS_GICD_ICENABLER8_ADDR A:0x6b0001a0
y.create.l HWIO_APCS_GICD_ISPENDR0_ADDR A:0x6b000200
y.create.l HWIO_APCS_GICD_ISPENDR1_ADDR A:0x6b000204
y.create.l HWIO_APCS_GICD_ISPENDR2_ADDR A:0x6b000208
y.create.l HWIO_APCS_GICD_ISPENDR3_ADDR A:0x6b00020c
y.create.l HWIO_APCS_GICD_ISPENDR4_ADDR A:0x6b000210
y.create.l HWIO_APCS_GICD_ISPENDR5_ADDR A:0x6b000214
y.create.l HWIO_APCS_GICD_ISPENDR6_ADDR A:0x6b000218
y.create.l HWIO_APCS_GICD_ISPENDR7_ADDR A:0x6b00021c
y.create.l HWIO_APCS_GICD_ISPENDR8_ADDR A:0x6b000220
y.create.l HWIO_APCS_GICD_ICPENDR0_ADDR A:0x6b000280
y.create.l HWIO_APCS_GICD_ICPENDR1_ADDR A:0x6b000284
y.create.l HWIO_APCS_GICD_ICPENDR2_ADDR A:0x6b000288
y.create.l HWIO_APCS_GICD_ICPENDR3_ADDR A:0x6b00028c
y.create.l HWIO_APCS_GICD_ICPENDR4_ADDR A:0x6b000290
y.create.l HWIO_APCS_GICD_ICPENDR5_ADDR A:0x6b000294
y.create.l HWIO_APCS_GICD_ICPENDR6_ADDR A:0x6b000298
y.create.l HWIO_APCS_GICD_ICPENDR7_ADDR A:0x6b00029c
y.create.l HWIO_APCS_GICD_ICPENDR8_ADDR A:0x6b0002a0
y.create.l HWIO_APCS_GICD_ISACTIVER0_ADDR A:0x6b000300
y.create.l HWIO_APCS_GICD_ISACTIVER1_ADDR A:0x6b000304
y.create.l HWIO_APCS_GICD_ISACTIVER2_ADDR A:0x6b000308
y.create.l HWIO_APCS_GICD_ISACTIVER3_ADDR A:0x6b00030c
y.create.l HWIO_APCS_GICD_ISACTIVER4_ADDR A:0x6b000310
y.create.l HWIO_APCS_GICD_ISACTIVER5_ADDR A:0x6b000314
y.create.l HWIO_APCS_GICD_ISACTIVER6_ADDR A:0x6b000318
y.create.l HWIO_APCS_GICD_ISACTIVER7_ADDR A:0x6b00031c
y.create.l HWIO_APCS_GICD_ISACTIVER8_ADDR A:0x6b000320
y.create.l HWIO_APCS_GICD_ICACTIVER0_ADDR A:0x6b000380
y.create.l HWIO_APCS_GICD_ICACTIVER1_ADDR A:0x6b000384
y.create.l HWIO_APCS_GICD_ICACTIVER2_ADDR A:0x6b000388
y.create.l HWIO_APCS_GICD_ICACTIVER3_ADDR A:0x6b00038c
y.create.l HWIO_APCS_GICD_ICACTIVER4_ADDR A:0x6b000390
y.create.l HWIO_APCS_GICD_ICACTIVER5_ADDR A:0x6b000394
y.create.l HWIO_APCS_GICD_ICACTIVER6_ADDR A:0x6b000398
y.create.l HWIO_APCS_GICD_ICACTIVER7_ADDR A:0x6b00039c
y.create.l HWIO_APCS_GICD_ICACTIVER8_ADDR A:0x6b0003a0
y.create.l HWIO_APCS_GICD_IPRIORITYR0_ADDR A:0x6b000400
y.create.l HWIO_APCS_GICD_IPRIORITYR1_ADDR A:0x6b000404
y.create.l HWIO_APCS_GICD_IPRIORITYR2_ADDR A:0x6b000408
y.create.l HWIO_APCS_GICD_IPRIORITYR3_ADDR A:0x6b00040c
y.create.l HWIO_APCS_GICD_IPRIORITYR4_ADDR A:0x6b000410
y.create.l HWIO_APCS_GICD_IPRIORITYR5_ADDR A:0x6b000414
y.create.l HWIO_APCS_GICD_IPRIORITYR6_ADDR A:0x6b000418
y.create.l HWIO_APCS_GICD_IPRIORITYR7_ADDR A:0x6b00041c
y.create.l HWIO_APCS_GICD_IPRIORITYR8_ADDR A:0x6b000420
y.create.l HWIO_APCS_GICD_IPRIORITYR9_ADDR A:0x6b000424
y.create.l HWIO_APCS_GICD_ITARGETSR0_ADDR A:0x6b000800
y.create.l HWIO_APCS_GICD_ITARGETSR1_ADDR A:0x6b000804
y.create.l HWIO_APCS_GICD_ITARGETSR2_ADDR A:0x6b000808
y.create.l HWIO_APCS_GICD_ITARGETSR3_ADDR A:0x6b00080c
y.create.l HWIO_APCS_GICD_ITARGETSR4_ADDR A:0x6b000810
y.create.l HWIO_APCS_GICD_ITARGETSR5_ADDR A:0x6b000814
y.create.l HWIO_APCS_GICD_ITARGETSR6_ADDR A:0x6b000818
y.create.l HWIO_APCS_GICD_ITARGETSR7_ADDR A:0x6b00081c
y.create.l HWIO_APCS_GICD_ITARGETSR8_ADDR A:0x6b000820
y.create.l HWIO_APCS_GICD_ITARGETSR9_ADDR A:0x6b000824
y.create.l HWIO_APCS_GICD_ICFGR0_ADDR A:0x6b000c00
y.create.l HWIO_APCS_GICD_ICFGR1_ADDR A:0x6b000c04
y.create.l HWIO_APCS_GICD_ICFGR2_ADDR A:0x6b000c08
y.create.l HWIO_APCS_GICD_ICFGR3_ADDR A:0x6b000c0c
y.create.l HWIO_APCS_GICD_ICFGR4_ADDR A:0x6b000c10
y.create.l HWIO_APCS_GICD_ICFGR5_ADDR A:0x6b000c14
y.create.l HWIO_APCS_GICD_ICFGR6_ADDR A:0x6b000c18
y.create.l HWIO_APCS_GICD_ICFGR7_ADDR A:0x6b000c1c
y.create.l HWIO_APCS_GICD_ICFGR8_ADDR A:0x6b000c20
y.create.l HWIO_APCS_GICD_ICFGR9_ADDR A:0x6b000c24
y.create.l HWIO_APCS_GICD_SGIR_ADDR A:0x6b000f00
y.create.l HWIO_APCS_GICD_CPENDSGIR0_ADDR A:0x6b000f10
y.create.l HWIO_APCS_GICD_CPENDSGIR1_ADDR A:0x6b000f14
y.create.l HWIO_APCS_GICD_CPENDSGIR2_ADDR A:0x6b000f18
y.create.l HWIO_APCS_GICD_CPENDSGIR3_ADDR A:0x6b000f1c
y.create.l HWIO_APCS_GICD_SPENDSGIR0_ADDR A:0x6b000f20
y.create.l HWIO_APCS_GICD_SPENDSGIR1_ADDR A:0x6b000f24
y.create.l HWIO_APCS_GICD_SPENDSGIR2_ADDR A:0x6b000f28
y.create.l HWIO_APCS_GICD_SPENDSGIR3_ADDR A:0x6b000f2c
y.create.l HWIO_APCS_GICD_PIDR0_ADDR A:0x6b000fd0
y.create.l HWIO_APCS_GICD_PIDR1_ADDR A:0x6b000fd4
y.create.l HWIO_APCS_GICD_PIDR2_ADDR A:0x6b000fd8
y.create.l HWIO_APCS_GICD_PIDR3_ADDR A:0x6b000fdc
y.create.l HWIO_APCS_GICD_PIDR4_ADDR A:0x6b000fe0
y.create.l HWIO_APCS_GICD_PIDR5_ADDR A:0x6b000fe4
y.create.l HWIO_APCS_GICD_PIDR6_ADDR A:0x6b000fe8
y.create.l HWIO_APCS_GICD_PIDR7_ADDR A:0x6b000fec
y.create.l HWIO_APCS_GICD_CIDR0_ADDR A:0x6b000ff0
y.create.l HWIO_APCS_GICD_CIDR1_ADDR A:0x6b000ff4
y.create.l HWIO_APCS_GICD_CIDR2_ADDR A:0x6b000ff8
y.create.l HWIO_APCS_GICD_CIDR3_ADDR A:0x6b000ffc
y.create.l HWIO_APCS_GICH_HCR_ADDR A:0x6b001000
y.create.l HWIO_APCS_GICH_VTR_ADDR A:0x6b001004
y.create.l HWIO_APCS_GICH_VMCR_ADDR A:0x6b001008
y.create.l HWIO_APCS_GICH_MISR_ADDR A:0x6b001010
y.create.l HWIO_APCS_GICH_EISR_ADDR A:0x6b001020
y.create.l HWIO_APCS_GICH_ELRSR_ADDR A:0x6b001030
y.create.l HWIO_APCS_GICH_APR_ADDR A:0x6b0010f0
y.create.l HWIO_APCS_GICH_LR0_ADDR A:0x6b001100
y.create.l HWIO_APCS_GICH_LR1_ADDR A:0x6b001104
y.create.l HWIO_APCS_GICH_LR2_ADDR A:0x6b001108
y.create.l HWIO_APCS_GICH_LR3_ADDR A:0x6b00110c
y.create.l HWIO_APCS_GICH_SW_LR_ADDR A:0x6b001120
y.create.l HWIO_APCS_GICC_CTLR_ADDR A:0x6b002000
y.create.l HWIO_APCS_GICC_PMR_ADDR A:0x6b002004
y.create.l HWIO_APCS_GICC_BPR_ADDR A:0x6b002008
y.create.l HWIO_APCS_GICC_IAR_ADDR A:0x6b00200c
y.create.l HWIO_APCS_GICC_EOIR_ADDR A:0x6b002010
y.create.l HWIO_APCS_GICC_RPR_ADDR A:0x6b002014
y.create.l HWIO_APCS_GICC_HPPIR_ADDR A:0x6b002018
y.create.l HWIO_APCS_GICC_ABPR_ADDR A:0x6b00201c
y.create.l HWIO_APCS_GICC_AIAR_ADDR A:0x6b002020
y.create.l HWIO_APCS_GICC_AEOIR_ADDR A:0x6b002024
y.create.l HWIO_APCS_GICC_AHPPIR_ADDR A:0x6b002028
y.create.l HWIO_APCS_GICC_APR_ADDR A:0x6b0020d0
y.create.l HWIO_APCS_GICC_NSAPR_ADDR A:0x6b0020e0
y.create.l HWIO_APCS_GICC_IIDR_ADDR A:0x6b0020fc
y.create.l HWIO_APCS_GICC_DIR_ADDR A:0x6b003000
y.create.l HWIO_APCS_GICV_CTLR_ADDR A:0x6b004000
y.create.l HWIO_APCS_GICV_PMR_ADDR A:0x6b004004
y.create.l HWIO_APCS_GICV_BPR_ADDR A:0x6b004008
y.create.l HWIO_APCS_GICV_IAR_ADDR A:0x6b00400c
y.create.l HWIO_APCS_GICV_EOIR_ADDR A:0x6b004010
y.create.l HWIO_APCS_GICV_RPR_ADDR A:0x6b004014
y.create.l HWIO_APCS_GICV_HPPIR_ADDR A:0x6b004018
y.create.l HWIO_APCS_GICV_ABPR_ADDR A:0x6b00401c
y.create.l HWIO_APCS_GICV_AIAR_ADDR A:0x6b004020
y.create.l HWIO_APCS_GICV_AEOIR_ADDR A:0x6b004024
y.create.l HWIO_APCS_GICV_AHPPIR_ADDR A:0x6b004028
y.create.l HWIO_APCS_GICV_APR_ADDR A:0x6b0040d0
y.create.l HWIO_APCS_GICV_IIDR_ADDR A:0x6b0040fc
y.create.l HWIO_APCS_GICV_DIR_ADDR A:0x6b005000
y.create.l HWIO_BIMC_HW_VERSION_ADDR A:0x60400000
y.create.l HWIO_BIMC_CORE_INFO_ADDR A:0x60400004
y.create.l HWIO_BIMC_HW_INFO_ADDR A:0x60400008
y.create.l HWIO_BIMC_DDR_CH0_CLK_2X_MODE_ADDR A:0x60400020
y.create.l HWIO_BIMC_DDR_CH0_CLK_PERIOD_ADDR A:0x60400028
y.create.l HWIO_BIMC_DDR_CH0_PHY_CLK_SEL_ADDR A:0x60400030
y.create.l HWIO_BIMC_SCMO0_LOCAL_CGC_THRESHOLD_ADDR A:0x60400100
y.create.l HWIO_BIMC_DPE0_LOCAL_CGC_THRESHOLD_ADDR A:0x60400140
y.create.l HWIO_BIMC_MPORT_CORE_DOMAIN_LOCAL_CGC_THRESHOLD_ADDR A:0x60400180
y.create.l HWIO_BIMC_MPORT0_CLK_LOCAL_CGC_THRESHOLD_ADDR A:0x604001c0
y.create.l HWIO_BIMC_MPORT1_CLK_LOCAL_CGC_THRESHOLD_ADDR A:0x604001c4
y.create.l HWIO_BIMC_MPORT2_CLK_LOCAL_CGC_THRESHOLD_ADDR A:0x604001c8
y.create.l HWIO_BIMC_MPORT3_CLK_LOCAL_CGC_THRESHOLD_ADDR A:0x604001cc
y.create.l HWIO_BIMC_MPORT4_CLK_LOCAL_CGC_THRESHOLD_ADDR A:0x604001d0
y.create.l HWIO_BIMC_MPORT5_CLK_LOCAL_CGC_THRESHOLD_ADDR A:0x604001d4
y.create.l HWIO_BIMC_MPORT6_CLK_LOCAL_CGC_THRESHOLD_ADDR A:0x604001d8
y.create.l HWIO_BIMC_SWAY_LOCAL_CGC_THRESHOLD_ADDR A:0x60400200
y.create.l HWIO_BIMC_SCMO0_CGC_CFG_ADDR A:0x60400240
y.create.l HWIO_BIMC_DPE0_CGC_CFG_ADDR A:0x60400280
y.create.l HWIO_BIMC_DDR_CH0_CAL_CFG_0_ADDR A:0x60400400
y.create.l HWIO_BIMC_DDR_CH0_CAL_CFG_1_ADDR A:0x60400410
y.create.l HWIO_BIMC_DDR_CH0_CAL_CFG_2_ADDR A:0x60400420
y.create.l HWIO_BIMC_DDR_CH0_CAL_CFG_3_ADDR A:0x60400428
y.create.l HWIO_BIMC_DDR_CH0_SW_CAL_ENA_ADDR A:0x60400430
y.create.l HWIO_BIMC_DDR_CH0_SW_CLKEN_DDRCC_ADDR A:0x60400438
y.create.l HWIO_BIMC_DDR_CH0_SW_CLKEN_CAPHY_ADDR A:0x60400440
y.create.l HWIO_BIMC_DDR_CH0_SW_CLKEN_DQPHY_ADDR A:0x60400448
y.create.l HWIO_BIMC_DDR_CH0_SW_CLK_READY_OVERRIDE_ADDR A:0x60400450
y.create.l HWIO_BIMC_DDR_CH0_DDRCC_CLK_EXTEND_ADDR A:0x60400460
y.create.l HWIO_BIMC_DDR_CH0_CAPHY_CLK_EXTEND_ADDR A:0x60400470
y.create.l HWIO_BIMC_DDR_CH0_DQPHY_CLK_EXTEND_ADDR A:0x60400480
y.create.l HWIO_BIMC_DFI0_LP_CFG_ADDR A:0x60400600
y.create.l HWIO_BIMC_DDR_CH0_HFSC_CFG_ADDR A:0x60400800
y.create.l HWIO_BIMC_DDR_CH0_HFSC_STATUS_ADDR A:0x60400810
y.create.l HWIO_BIMC_DDR_CH0_HFSC_STAGE1_CTRL_ADDR A:0x60400820
y.create.l HWIO_BIMC_DDR_CH0_HFSC_STAGE2_CTRL_ADDR A:0x60400830
y.create.l HWIO_BIMC_DDR_CH0_HFSC_STAGE1_HANDSHAKE_CTRL_ADDR A:0x60400840
y.create.l HWIO_BIMC_DDR_CH0_HFSC_STAGE2_HANDSHAKE_CTRL_ADDR A:0x60400850
y.create.l HWIO_BIMC_QOS_CTRL_ADDR A:0x60400900
y.create.l HWIO_BIMC_QOS_CFG_ADDR A:0x60400904
y.create.l HWIO_BIMC_QOS_TIMEOUT_CNT_LOW_URGENCY_ADDR A:0x60400908
y.create.l HWIO_BIMC_QOS_TIMEOUT_CNT_HIGH_URGENCY_ADDR A:0x6040090c
y.create.l HWIO_BIMC_QOS_STATUS_ADDR A:0x60400910
y.create.l HWIO_BIMC_QOS_STATUS_CLR_ADDR A:0x60400914
y.create.l HWIO_BIMC_QOS_FSSH_CTRL_ADDR A:0x60400920
y.create.l HWIO_BIMC_QOS_FSSH_FREQ_THRESHOLD_URGENCY_BAND0_ADDR A:0x60400930
y.create.l HWIO_BIMC_QOS_FSSH_URGENCY_SEL_ADDR A:0x60400940
y.create.l HWIO_BIMC_BRIC_GLOBAL1_COMPONENT_INFO_ADDR A:0x60401000
y.create.l HWIO_BIMC_BRIC_HW_INFO_ADDR A:0x60401010
y.create.l HWIO_BIMC_BRIC_HW_VERSION_ADDR A:0x60401014
y.create.l HWIO_BIMC_BRIC_CONFIGURATION_INFO_0_ADDR A:0x60401020
y.create.l HWIO_BIMC_BRIC_CONFIGURATION_INFO_1_ADDR A:0x60401030
y.create.l HWIO_BIMC_BRIC_CONFIGURATION_INFO_2A_ADDR A:0x60401040
y.create.l HWIO_BIMC_BRIC_CONFIGURATION_INFO_2B_ADDR A:0x60401044
y.create.l HWIO_BIMC_BRIC_CONFIGURATION_INFO_2C_ADDR A:0x60401048
y.create.l HWIO_BIMC_BRIC_CONFIGURATION_INFO_2D_ADDR A:0x6040104c
y.create.l HWIO_BIMC_BRIC_INTERRUPT_STATUS_0_ADDR A:0x60401100
y.create.l HWIO_BIMC_BRIC_INTERRUPT_CLEAR_0_ADDR A:0x60401108
y.create.l HWIO_BIMC_BRIC_INTERRUPT_ENABLE_0_ADDR A:0x6040110c
y.create.l HWIO_BIMC_BRIC_INTERRUPT_STATUS_1_ADDR A:0x60401110
y.create.l HWIO_BIMC_BRIC_INTERRUPT_CLEAR_1_ADDR A:0x60401118
y.create.l HWIO_BIMC_BRIC_INTERRUPT_ENABLE_1_ADDR A:0x6040111c
y.create.l HWIO_BIMC_BRIC_INTERRUPT_STATUS_2_ADDR A:0x60401120
y.create.l HWIO_BIMC_BRIC_INTERRUPT_CLEAR_2_ADDR A:0x60401128
y.create.l HWIO_BIMC_BRIC_INTERRUPT_ENABLE_2_ADDR A:0x6040112c
y.create.l HWIO_BIMC_BRIC_INTERRUPT_STATUS_3_ADDR A:0x60401130
y.create.l HWIO_BIMC_BRIC_INTERRUPT_CLEAR_3_ADDR A:0x60401138
y.create.l HWIO_BIMC_BRIC_INTERRUPT_ENABLE_3_ADDR A:0x6040113c
y.create.l HWIO_BIMC_BRIC_REF_TIMER_INTERVAL_ADDR A:0x60401200
y.create.l HWIO_BIMC_BRIC_DEBUG_SELECT_ADDR A:0x60401210
y.create.l HWIO_BIMC_BRIC_MSA_LOCKS_ADDR A:0x60401300
y.create.l HWIO_BIMC_BRIC_PROTNS_LOCKS_ADDR A:0x60401310
y.create.l HWIO_BIMC_BRIC_GLOBAL2_COMPONENT_INFO_ADDR A:0x60402000
y.create.l HWIO_BIMC_BRIC_DEFAULT_SEGMENT_ADDR A:0x604021f0
y.create.l HWIO_BIMC_BRIC_SEGMENT0_ADDR_BASE_A_LOWER_ADDR A:0x60402200
y.create.l HWIO_BIMC_BRIC_SEGMENT1_ADDR_BASE_A_LOWER_ADDR A:0x60402280
y.create.l HWIO_BIMC_BRIC_SEGMENT2_ADDR_BASE_A_LOWER_ADDR A:0x60402300
y.create.l HWIO_BIMC_BRIC_SEGMENT0_ADDR_BASE_A_UPPER_ADDR A:0x60402204
y.create.l HWIO_BIMC_BRIC_SEGMENT1_ADDR_BASE_A_UPPER_ADDR A:0x60402284
y.create.l HWIO_BIMC_BRIC_SEGMENT2_ADDR_BASE_A_UPPER_ADDR A:0x60402304
y.create.l HWIO_BIMC_BRIC_SEGMENT0_ADDR_MASK_A_LOWER_ADDR A:0x60402208
y.create.l HWIO_BIMC_BRIC_SEGMENT1_ADDR_MASK_A_LOWER_ADDR A:0x60402288
y.create.l HWIO_BIMC_BRIC_SEGMENT2_ADDR_MASK_A_LOWER_ADDR A:0x60402308
y.create.l HWIO_BIMC_BRIC_SEGMENT0_ADDR_MASK_A_UPPER_ADDR A:0x6040220c
y.create.l HWIO_BIMC_BRIC_SEGMENT1_ADDR_MASK_A_UPPER_ADDR A:0x6040228c
y.create.l HWIO_BIMC_BRIC_SEGMENT2_ADDR_MASK_A_UPPER_ADDR A:0x6040230c
y.create.l HWIO_BIMC_BRIC_SEGMENT0_ADDR_BASE_B_LOWER_ADDR A:0x60402210
y.create.l HWIO_BIMC_BRIC_SEGMENT1_ADDR_BASE_B_LOWER_ADDR A:0x60402290
y.create.l HWIO_BIMC_BRIC_SEGMENT2_ADDR_BASE_B_LOWER_ADDR A:0x60402310
y.create.l HWIO_BIMC_BRIC_SEGMENT0_ADDR_BASE_B_UPPER_ADDR A:0x60402214
y.create.l HWIO_BIMC_BRIC_SEGMENT1_ADDR_BASE_B_UPPER_ADDR A:0x60402294
y.create.l HWIO_BIMC_BRIC_SEGMENT2_ADDR_BASE_B_UPPER_ADDR A:0x60402314
y.create.l HWIO_BIMC_BRIC_SEGMENT0_ADDR_MASK_B_LOWER_ADDR A:0x60402218
y.create.l HWIO_BIMC_BRIC_SEGMENT1_ADDR_MASK_B_LOWER_ADDR A:0x60402298
y.create.l HWIO_BIMC_BRIC_SEGMENT2_ADDR_MASK_B_LOWER_ADDR A:0x60402318
y.create.l HWIO_BIMC_BRIC_SEGMENT0_ADDR_MASK_B_UPPER_ADDR A:0x6040221c
y.create.l HWIO_BIMC_BRIC_SEGMENT1_ADDR_MASK_B_UPPER_ADDR A:0x6040229c
y.create.l HWIO_BIMC_BRIC_SEGMENT2_ADDR_MASK_B_UPPER_ADDR A:0x6040231c
y.create.l HWIO_BIMC_BRIC_SEGMENT0_ADDR_BASE_C_LOWER_ADDR A:0x60402220
y.create.l HWIO_BIMC_BRIC_SEGMENT1_ADDR_BASE_C_LOWER_ADDR A:0x604022a0
y.create.l HWIO_BIMC_BRIC_SEGMENT2_ADDR_BASE_C_LOWER_ADDR A:0x60402320
y.create.l HWIO_BIMC_BRIC_SEGMENT0_ADDR_BASE_C_UPPER_ADDR A:0x60402224
y.create.l HWIO_BIMC_BRIC_SEGMENT1_ADDR_BASE_C_UPPER_ADDR A:0x604022a4
y.create.l HWIO_BIMC_BRIC_SEGMENT2_ADDR_BASE_C_UPPER_ADDR A:0x60402324
y.create.l HWIO_BIMC_BRIC_SEGMENT0_ADDR_MASK_C_LOWER_ADDR A:0x60402228
y.create.l HWIO_BIMC_BRIC_SEGMENT1_ADDR_MASK_C_LOWER_ADDR A:0x604022a8
y.create.l HWIO_BIMC_BRIC_SEGMENT2_ADDR_MASK_C_LOWER_ADDR A:0x60402328
y.create.l HWIO_BIMC_BRIC_SEGMENT0_ADDR_MASK_C_UPPER_ADDR A:0x6040222c
y.create.l HWIO_BIMC_BRIC_SEGMENT1_ADDR_MASK_C_UPPER_ADDR A:0x604022ac
y.create.l HWIO_BIMC_BRIC_SEGMENT2_ADDR_MASK_C_UPPER_ADDR A:0x6040232c
y.create.l HWIO_BIMC_BRIC_REMAP0_ADDR_BASE_LOWER_ADDR A:0x60402a00
y.create.l HWIO_BIMC_BRIC_REMAP1_ADDR_BASE_LOWER_ADDR A:0x60402a40
y.create.l HWIO_BIMC_BRIC_REMAP2_ADDR_BASE_LOWER_ADDR A:0x60402a80
y.create.l HWIO_BIMC_BRIC_REMAP3_ADDR_BASE_LOWER_ADDR A:0x60402ac0
y.create.l HWIO_BIMC_BRIC_REMAP0_ADDR_BASE_UPPER_ADDR A:0x60402a04
y.create.l HWIO_BIMC_BRIC_REMAP1_ADDR_BASE_UPPER_ADDR A:0x60402a44
y.create.l HWIO_BIMC_BRIC_REMAP2_ADDR_BASE_UPPER_ADDR A:0x60402a84
y.create.l HWIO_BIMC_BRIC_REMAP3_ADDR_BASE_UPPER_ADDR A:0x60402ac4
y.create.l HWIO_BIMC_BRIC_REMAP0_ADDR_MASK_LOWER_ADDR A:0x60402a08
y.create.l HWIO_BIMC_BRIC_REMAP1_ADDR_MASK_LOWER_ADDR A:0x60402a48
y.create.l HWIO_BIMC_BRIC_REMAP2_ADDR_MASK_LOWER_ADDR A:0x60402a88
y.create.l HWIO_BIMC_BRIC_REMAP3_ADDR_MASK_LOWER_ADDR A:0x60402ac8
y.create.l HWIO_BIMC_BRIC_REMAP0_ADDR_MASK_UPPER_ADDR A:0x60402a0c
y.create.l HWIO_BIMC_BRIC_REMAP1_ADDR_MASK_UPPER_ADDR A:0x60402a4c
y.create.l HWIO_BIMC_BRIC_REMAP2_ADDR_MASK_UPPER_ADDR A:0x60402a8c
y.create.l HWIO_BIMC_BRIC_REMAP3_ADDR_MASK_UPPER_ADDR A:0x60402acc
y.create.l HWIO_BIMC_BRIC_REMAP0_OP0_ADDR A:0x60402a20
y.create.l HWIO_BIMC_BRIC_REMAP1_OP0_ADDR A:0x60402a60
y.create.l HWIO_BIMC_BRIC_REMAP2_OP0_ADDR A:0x60402aa0
y.create.l HWIO_BIMC_BRIC_REMAP3_OP0_ADDR A:0x60402ae0
y.create.l HWIO_BIMC_BRIC_REMAP0_OP1_ADDR A:0x60402a24
y.create.l HWIO_BIMC_BRIC_REMAP1_OP1_ADDR A:0x60402a64
y.create.l HWIO_BIMC_BRIC_REMAP2_OP1_ADDR A:0x60402aa4
y.create.l HWIO_BIMC_BRIC_REMAP3_OP1_ADDR A:0x60402ae4
y.create.l HWIO_BIMC_PERFMON_COMPONENT_INFO_ADDR A:0x60403000
y.create.l HWIO_BIMC_PERFMON_CONFIGURATION_INFO_ADDR A:0x60403020
y.create.l HWIO_BIMC_PERFMON_CLOCK_CTRL_ADDR A:0x60403200
y.create.l HWIO_BIMC_PERFMON_MODE_ADDR A:0x60403210
y.create.l HWIO_BIMC_PERFMON_DUMP_ADDR A:0x60403214
y.create.l HWIO_BIMC_PERFMON_TIMED_MODE_INTERVAL_ADDR A:0x60403220
y.create.l HWIO_BIMC_PERFMON_TIMED_MODE_ITERATIONS_ADDR A:0x60403230
y.create.l HWIO_BIMC_PERFMON_STATUS_ADDR A:0x604032f0
y.create.l HWIO_BIMC_PERFMON_COUNTER_0_CONFIG_ADDR A:0x60403300
y.create.l HWIO_BIMC_PERFMON_COUNTER_1_CONFIG_ADDR A:0x60403310
y.create.l HWIO_BIMC_PERFMON_COUNTER_2_CONFIG_ADDR A:0x60403320
y.create.l HWIO_BIMC_PERFMON_COUNTER_3_CONFIG_ADDR A:0x60403330
y.create.l HWIO_BIMC_PERFMON_COUNTER_4_CONFIG_ADDR A:0x60403340
y.create.l HWIO_BIMC_PERFMON_COUNTER_5_CONFIG_ADDR A:0x60403350
y.create.l HWIO_BIMC_PERFMON_COUNTER_6_CONFIG_ADDR A:0x60403360
y.create.l HWIO_BIMC_PERFMON_COUNTER_7_CONFIG_ADDR A:0x60403370
y.create.l HWIO_BIMC_PERFMON_COUNTER_8_CONFIG_ADDR A:0x60403380
y.create.l HWIO_BIMC_PERFMON_COUNTER_9_CONFIG_ADDR A:0x60403390
y.create.l HWIO_BIMC_PERFMON_COUNTER_0_ADDR A:0x60403308
y.create.l HWIO_BIMC_PERFMON_COUNTER_1_ADDR A:0x60403318
y.create.l HWIO_BIMC_PERFMON_COUNTER_2_ADDR A:0x60403328
y.create.l HWIO_BIMC_PERFMON_COUNTER_3_ADDR A:0x60403338
y.create.l HWIO_BIMC_PERFMON_COUNTER_4_ADDR A:0x60403348
y.create.l HWIO_BIMC_PERFMON_COUNTER_5_ADDR A:0x60403358
y.create.l HWIO_BIMC_PERFMON_COUNTER_6_ADDR A:0x60403368
y.create.l HWIO_BIMC_PERFMON_COUNTER_7_ADDR A:0x60403378
y.create.l HWIO_BIMC_PERFMON_COUNTER_8_ADDR A:0x60403388
y.create.l HWIO_BIMC_PERFMON_COUNTER_9_ADDR A:0x60403398
y.create.l HWIO_BIMC_PERFMON_COUNTER_0_OVERFLOW_ADDR A:0x6040330c
y.create.l HWIO_BIMC_PERFMON_COUNTER_1_OVERFLOW_ADDR A:0x6040331c
y.create.l HWIO_BIMC_PERFMON_COUNTER_2_OVERFLOW_ADDR A:0x6040332c
y.create.l HWIO_BIMC_PERFMON_COUNTER_3_OVERFLOW_ADDR A:0x6040333c
y.create.l HWIO_BIMC_PERFMON_COUNTER_4_OVERFLOW_ADDR A:0x6040334c
y.create.l HWIO_BIMC_PERFMON_COUNTER_5_OVERFLOW_ADDR A:0x6040335c
y.create.l HWIO_BIMC_PERFMON_COUNTER_6_OVERFLOW_ADDR A:0x6040336c
y.create.l HWIO_BIMC_PERFMON_COUNTER_7_OVERFLOW_ADDR A:0x6040337c
y.create.l HWIO_BIMC_PERFMON_COUNTER_8_OVERFLOW_ADDR A:0x6040338c
y.create.l HWIO_BIMC_PERFMON_COUNTER_9_OVERFLOW_ADDR A:0x6040339c
y.create.l HWIO_BIMC_DTE_HW_INFO_ADDR A:0x60406000
y.create.l HWIO_BIMC_DTE_GLOBAL_CNTL_ADDR A:0x60406004
y.create.l HWIO_BIMC_DTE_PROGRAM_CNTL_ADDR A:0x6040600c
y.create.l HWIO_BIMC_DTE_REG_CNTL_ADDR A:0x60406010
y.create.l HWIO_BIMC_DTE_REG_DATA_ADDR A:0x60406014
y.create.l HWIO_BIMC_DTE_TEST_STATUS_DDR_ADDR A:0x60406020
y.create.l HWIO_BIMC_DTE_TEST_STATUS_QSB_ADDR A:0x60406024
y.create.l HWIO_BIMC_DTE_TEST_MEM_CNTL_ADDR A:0x60406030
y.create.l HWIO_BIMC_DTE_TEST_MEM_DATA_0_ADDR A:0x60406038
y.create.l HWIO_BIMC_DTE_TEST_MEM_DATA_1_ADDR A:0x6040603c
y.create.l HWIO_BIMC_M_APP_MPORT_COMPONENT_INFO_ADDR A:0x60408000
y.create.l HWIO_BIMC_M_APP_MPORT_CONFIGURATION_INFO_0_ADDR A:0x60408020
y.create.l HWIO_BIMC_M_APP_MPORT_CONFIGURATION_INFO_1_ADDR A:0x60408030
y.create.l HWIO_BIMC_M_APP_MPORT_CONFIGURATION_INFO_2A_ADDR A:0x60408040
y.create.l HWIO_BIMC_M_APP_MPORT_CONFIGURATION_INFO_2B_ADDR A:0x60408044
y.create.l HWIO_BIMC_M_APP_MPORT_CONFIGURATION_INFO_3_ADDR A:0x60408050
y.create.l HWIO_BIMC_M_APP_MPORT_CONFIGURATION_INFO_4_ADDR A:0x60408060
y.create.l HWIO_BIMC_M_APP_MPORT_CONFIGURATION_INFO_5A_ADDR A:0x60408070
y.create.l HWIO_BIMC_M_APP_MPORT_CONFIGURATION_INFO_5B_ADDR A:0x60408074
y.create.l HWIO_BIMC_M_APP_MPORT_CONFIGURATION_INFO_5C_ADDR A:0x60408078
y.create.l HWIO_BIMC_M_APP_MPORT_CONFIGURATION_INFO_5D_ADDR A:0x6040807c
y.create.l HWIO_BIMC_M_APP_MPORT_INTERRUPT_STATUS_ADDR A:0x60408100
y.create.l HWIO_BIMC_M_APP_MPORT_INTERRUPT_CLEAR_ADDR A:0x60408108
y.create.l HWIO_BIMC_M_APP_MPORT_INTERRUPT_ENABLE_ADDR A:0x6040810c
y.create.l HWIO_BIMC_M_APP_MPORT_CLOCK_CTRL_ADDR A:0x60408200
y.create.l HWIO_BIMC_M_APP_MPORT_CDC_CTRL_ADDR A:0x60408208
y.create.l HWIO_BIMC_M_APP_MPORT_MODE_ADDR A:0x60408210
y.create.l HWIO_BIMC_M_APP_MPORT_WR_WAY_CROSSING_ADDR A:0x60408220
y.create.l HWIO_BIMC_M_APP_MPORT_PRIORITYLVL_OVERRIDE_ADDR A:0x60408230
y.create.l HWIO_BIMC_M_APP_MPORT_READ_COMMAND_OVERRIDE_ADDR A:0x60408240
y.create.l HWIO_BIMC_M_APP_MPORT_WRITE_COMMAND_OVERRIDE_ADDR A:0x60408250
y.create.l HWIO_BIMC_M_APP_MPORT_RD_TRACKING_INDEX_ADDR A:0x60408270
y.create.l HWIO_BIMC_M_APP_MPORT_WR_TRACKING_INDEX_ADDR A:0x60408274
y.create.l HWIO_BIMC_M_APP_MPORT_BWMON_ENABLE_ADDR A:0x60408280
y.create.l HWIO_BIMC_M_APP_MPORT_BWMON_CLEAR_ADDR A:0x60408284
y.create.l HWIO_BIMC_M_APP_MPORT_BWMON_BYTE_COUNT_ADDR A:0x60408288
y.create.l HWIO_BIMC_M_APP_MPORT_BWMON_THRESHOLD_ADDR A:0x60408290
y.create.l HWIO_BIMC_M_APP_MPORT_BWMON_MID_MASK_ADDR A:0x60408298
y.create.l HWIO_BIMC_M_APP_MPORT_BWMON_MID_MATCH_ADDR A:0x6040829c
y.create.l HWIO_BIMC_M_APP_MPORT_BKE_ENABLE_ADDR A:0x60408300
y.create.l HWIO_BIMC_M_APP_MPORT_BKE_GRANT_PERIOD_ADDR A:0x60408304
y.create.l HWIO_BIMC_M_APP_MPORT_BKE_GRANT_COUNT_ADDR A:0x60408308
y.create.l HWIO_BIMC_M_APP_MPORT_BKE_THRESHOLD_HIGH_ADDR A:0x60408320
y.create.l HWIO_BIMC_M_APP_MPORT_BKE_THRESHOLD_MEDIUM_ADDR A:0x60408324
y.create.l HWIO_BIMC_M_APP_MPORT_BKE_THRESHOLD_LOW_ADDR A:0x60408328
y.create.l HWIO_BIMC_M_APP_MPORT_BKE_HEALTH_0_ADDR A:0x60408340
y.create.l HWIO_BIMC_M_APP_MPORT_BKE_HEALTH_1_ADDR A:0x60408344
y.create.l HWIO_BIMC_M_APP_MPORT_BKE_HEALTH_2_ADDR A:0x60408348
y.create.l HWIO_BIMC_M_APP_MPORT_BKE_HEALTH_3_ADDR A:0x6040834c
y.create.l HWIO_BIMC_M_APP_MPORT_STATUS_2A_ADDR A:0x60408420
y.create.l HWIO_BIMC_M_APP_MPORT_STATUS_2B_ADDR A:0x60408424
y.create.l HWIO_BIMC_M_APP_MPORT_STATUS_3A_ADDR A:0x60408430
y.create.l HWIO_BIMC_M_APP_MPORT_STATUS_3B_ADDR A:0x60408434
y.create.l HWIO_BIMC_M_APP_MPORT_BKE1_ENABLE_ADDR A:0x60408800
y.create.l HWIO_BIMC_M_APP_MPORT_BKE1_GRANT_PERIOD_ADDR A:0x60408804
y.create.l HWIO_BIMC_M_APP_MPORT_BKE1_GRANT_COUNT_ADDR A:0x60408808
y.create.l HWIO_BIMC_M_APP_MPORT_BKE1_THRESHOLD_HIGH_ADDR A:0x60408820
y.create.l HWIO_BIMC_M_APP_MPORT_BKE1_THRESHOLD_MEDIUM_ADDR A:0x60408824
y.create.l HWIO_BIMC_M_APP_MPORT_BKE1_THRESHOLD_LOW_ADDR A:0x60408828
y.create.l HWIO_BIMC_M_APP_MPORT_BKE1_HEALTH_0_ADDR A:0x60408840
y.create.l HWIO_BIMC_M_APP_MPORT_BKE1_HEALTH_1_ADDR A:0x60408844
y.create.l HWIO_BIMC_M_APP_MPORT_BKE1_HEALTH_2_ADDR A:0x60408848
y.create.l HWIO_BIMC_M_APP_MPORT_BKE1_HEALTH_3_ADDR A:0x6040884c
y.create.l HWIO_BIMC_M_APP_MPORT_BKE2_ENABLE_ADDR A:0x60408900
y.create.l HWIO_BIMC_M_APP_MPORT_BKE2_GRANT_PERIOD_ADDR A:0x60408904
y.create.l HWIO_BIMC_M_APP_MPORT_BKE2_GRANT_COUNT_ADDR A:0x60408908
y.create.l HWIO_BIMC_M_APP_MPORT_BKE2_THRESHOLD_HIGH_ADDR A:0x60408920
y.create.l HWIO_BIMC_M_APP_MPORT_BKE2_THRESHOLD_MEDIUM_ADDR A:0x60408924
y.create.l HWIO_BIMC_M_APP_MPORT_BKE2_THRESHOLD_LOW_ADDR A:0x60408928
y.create.l HWIO_BIMC_M_APP_MPORT_BKE2_HEALTH_0_ADDR A:0x60408940
y.create.l HWIO_BIMC_M_APP_MPORT_BKE2_HEALTH_1_ADDR A:0x60408944
y.create.l HWIO_BIMC_M_APP_MPORT_BKE2_HEALTH_2_ADDR A:0x60408948
y.create.l HWIO_BIMC_M_APP_MPORT_BKE2_HEALTH_3_ADDR A:0x6040894c
y.create.l HWIO_BIMC_M_APP_MPORT_BKE3_ENABLE_ADDR A:0x60408a00
y.create.l HWIO_BIMC_M_APP_MPORT_BKE3_GRANT_PERIOD_ADDR A:0x60408a04
y.create.l HWIO_BIMC_M_APP_MPORT_BKE3_GRANT_COUNT_ADDR A:0x60408a08
y.create.l HWIO_BIMC_M_APP_MPORT_BKE3_THRESHOLD_HIGH_ADDR A:0x60408a20
y.create.l HWIO_BIMC_M_APP_MPORT_BKE3_THRESHOLD_MEDIUM_ADDR A:0x60408a24
y.create.l HWIO_BIMC_M_APP_MPORT_BKE3_THRESHOLD_LOW_ADDR A:0x60408a28
y.create.l HWIO_BIMC_M_APP_MPORT_BKE3_HEALTH_0_ADDR A:0x60408a40
y.create.l HWIO_BIMC_M_APP_MPORT_BKE3_HEALTH_1_ADDR A:0x60408a44
y.create.l HWIO_BIMC_M_APP_MPORT_BKE3_HEALTH_2_ADDR A:0x60408a48
y.create.l HWIO_BIMC_M_APP_MPORT_BKE3_HEALTH_3_ADDR A:0x60408a4c
y.create.l HWIO_BIMC_M_APP_PROF_COMPONENT_INFO_ADDR A:0x60409000
y.create.l HWIO_BIMC_M_APP_PROF_CONFIGURATION_INFO_0_ADDR A:0x60409020
y.create.l HWIO_BIMC_M_APP_PROF_CONFIGURATION_INFO_1_ADDR A:0x60409030
y.create.l HWIO_BIMC_M_APP_PROF_CLOCK_CTRL_ADDR A:0x60409200
y.create.l HWIO_BIMC_M_APP_PROF_MODE_ADDR A:0x60409210
y.create.l HWIO_BIMC_M_APP_PROF_RD_TENURE_THRESHOLD_ADDR A:0x60409214
y.create.l HWIO_BIMC_M_APP_PROF_WR_TENURE_THRESHOLD_ADDR A:0x60409218
y.create.l HWIO_BIMC_M_APP_PROF_SWAY_SELECT_ADDR A:0x60409220
y.create.l HWIO_BIMC_M_APP_PROF_MID_MASK_ADDR A:0x60409230
y.create.l HWIO_BIMC_M_APP_PROF_MID_MATCH_ADDR A:0x60409234
y.create.l HWIO_BIMC_M_APP_PROF_MID_INV_MATCH_ADDR A:0x60409238
y.create.l HWIO_BIMC_M_APP_PROF_ADDR_MASK_LOWER_ADDR A:0x60409240
y.create.l HWIO_BIMC_M_APP_PROF_ADDR_MASK_UPPER_ADDR A:0x60409244
y.create.l HWIO_BIMC_M_APP_PROF_ADDR_MATCH_LOWER_ADDR A:0x60409248
y.create.l HWIO_BIMC_M_APP_PROF_ADDR_MATCH_UPPER_ADDR A:0x6040924c
y.create.l HWIO_BIMC_M_APP_PROF_ADDR_INV_MATCH_ADDR A:0x60409250
y.create.l HWIO_BIMC_M_APP_PROF_ACH_MASK_0_ADDR A:0x60409260
y.create.l HWIO_BIMC_M_APP_PROF_ACH_MATCH_0_ADDR A:0x60409264
y.create.l HWIO_BIMC_M_APP_PROF_ACH_MASK_1_ADDR A:0x60409270
y.create.l HWIO_BIMC_M_APP_PROF_ACH_MATCH_1_ADDR A:0x60409274
y.create.l HWIO_BIMC_M_APP_PROF_ACH_INV_MATCH_1_ADDR A:0x60409278
y.create.l HWIO_BIMC_M_APP_PROF_ACH_MASK_2_ADDR A:0x60409280
y.create.l HWIO_BIMC_M_APP_PROF_ACH_MATCH_2_ADDR A:0x60409284
y.create.l HWIO_BIMC_M_APP_PROF_ACH_MASK_3_ADDR A:0x60409290
y.create.l HWIO_BIMC_M_APP_PROF_ACH_MATCH_3_ADDR A:0x60409294
y.create.l HWIO_BIMC_M_APP_PROF_ACH_INV_MATCH_3_ADDR A:0x60409298
y.create.l HWIO_BIMC_M_APP_PROF_ACH_MASK_4_ADDR A:0x604092a0
y.create.l HWIO_BIMC_M_APP_PROF_ACH_MATCH_4_ADDR A:0x604092a4
y.create.l HWIO_BIMC_M_APP_PROF_ACH_INV_MATCH_4_ADDR A:0x604092a8
y.create.l HWIO_BIMC_M_APP_PROF_BCH_MASK_ADDR A:0x60409300
y.create.l HWIO_BIMC_M_APP_PROF_BCH_MATCH_ADDR A:0x60409304
y.create.l HWIO_BIMC_M_APP_PROF_BCH_INV_MATCH_ADDR A:0x60409308
y.create.l HWIO_BIMC_M_APP_PROF_RCH_MASK_ADDR A:0x60409340
y.create.l HWIO_BIMC_M_APP_PROF_RCH_MATCH_ADDR A:0x60409344
y.create.l HWIO_BIMC_M_APP_PROF_RCH_INV_MATCH_ADDR A:0x60409348
y.create.l HWIO_BIMC_M_APP_PROF_RD_STATUS_0_ADDR A:0x60409400
y.create.l HWIO_BIMC_M_APP_PROF_WR_STATUS_0_ADDR A:0x60409410
y.create.l HWIO_BIMC_M_DSP_MPORT_COMPONENT_INFO_ADDR A:0x6040c000
y.create.l HWIO_BIMC_M_DSP_MPORT_CONFIGURATION_INFO_0_ADDR A:0x6040c020
y.create.l HWIO_BIMC_M_DSP_MPORT_CONFIGURATION_INFO_1_ADDR A:0x6040c030
y.create.l HWIO_BIMC_M_DSP_MPORT_CONFIGURATION_INFO_2A_ADDR A:0x6040c040
y.create.l HWIO_BIMC_M_DSP_MPORT_CONFIGURATION_INFO_2B_ADDR A:0x6040c044
y.create.l HWIO_BIMC_M_DSP_MPORT_CONFIGURATION_INFO_3_ADDR A:0x6040c050
y.create.l HWIO_BIMC_M_DSP_MPORT_CONFIGURATION_INFO_4_ADDR A:0x6040c060
y.create.l HWIO_BIMC_M_DSP_MPORT_CONFIGURATION_INFO_5A_ADDR A:0x6040c070
y.create.l HWIO_BIMC_M_DSP_MPORT_CONFIGURATION_INFO_5B_ADDR A:0x6040c074
y.create.l HWIO_BIMC_M_DSP_MPORT_CONFIGURATION_INFO_5C_ADDR A:0x6040c078
y.create.l HWIO_BIMC_M_DSP_MPORT_CONFIGURATION_INFO_5D_ADDR A:0x6040c07c
y.create.l HWIO_BIMC_M_DSP_MPORT_INTERRUPT_STATUS_ADDR A:0x6040c100
y.create.l HWIO_BIMC_M_DSP_MPORT_INTERRUPT_CLEAR_ADDR A:0x6040c108
y.create.l HWIO_BIMC_M_DSP_MPORT_INTERRUPT_ENABLE_ADDR A:0x6040c10c
y.create.l HWIO_BIMC_M_DSP_MPORT_CLOCK_CTRL_ADDR A:0x6040c200
y.create.l HWIO_BIMC_M_DSP_MPORT_CDC_CTRL_ADDR A:0x6040c208
y.create.l HWIO_BIMC_M_DSP_MPORT_MODE_ADDR A:0x6040c210
y.create.l HWIO_BIMC_M_DSP_MPORT_WR_WAY_CROSSING_ADDR A:0x6040c220
y.create.l HWIO_BIMC_M_DSP_MPORT_PRIORITYLVL_OVERRIDE_ADDR A:0x6040c230
y.create.l HWIO_BIMC_M_DSP_MPORT_READ_COMMAND_OVERRIDE_ADDR A:0x6040c240
y.create.l HWIO_BIMC_M_DSP_MPORT_WRITE_COMMAND_OVERRIDE_ADDR A:0x6040c250
y.create.l HWIO_BIMC_M_DSP_MPORT_RD_TRACKING_INDEX_ADDR A:0x6040c270
y.create.l HWIO_BIMC_M_DSP_MPORT_WR_TRACKING_INDEX_ADDR A:0x6040c274
y.create.l HWIO_BIMC_M_DSP_MPORT_BWMON_ENABLE_ADDR A:0x6040c280
y.create.l HWIO_BIMC_M_DSP_MPORT_BWMON_CLEAR_ADDR A:0x6040c284
y.create.l HWIO_BIMC_M_DSP_MPORT_BWMON_BYTE_COUNT_ADDR A:0x6040c288
y.create.l HWIO_BIMC_M_DSP_MPORT_BWMON_THRESHOLD_ADDR A:0x6040c290
y.create.l HWIO_BIMC_M_DSP_MPORT_BWMON_MID_MASK_ADDR A:0x6040c298
y.create.l HWIO_BIMC_M_DSP_MPORT_BWMON_MID_MATCH_ADDR A:0x6040c29c
y.create.l HWIO_BIMC_M_DSP_MPORT_BKE_ENABLE_ADDR A:0x6040c300
y.create.l HWIO_BIMC_M_DSP_MPORT_BKE_GRANT_PERIOD_ADDR A:0x6040c304
y.create.l HWIO_BIMC_M_DSP_MPORT_BKE_GRANT_COUNT_ADDR A:0x6040c308
y.create.l HWIO_BIMC_M_DSP_MPORT_BKE_THRESHOLD_HIGH_ADDR A:0x6040c320
y.create.l HWIO_BIMC_M_DSP_MPORT_BKE_THRESHOLD_MEDIUM_ADDR A:0x6040c324
y.create.l HWIO_BIMC_M_DSP_MPORT_BKE_THRESHOLD_LOW_ADDR A:0x6040c328
y.create.l HWIO_BIMC_M_DSP_MPORT_BKE_HEALTH_0_ADDR A:0x6040c340
y.create.l HWIO_BIMC_M_DSP_MPORT_BKE_HEALTH_1_ADDR A:0x6040c344
y.create.l HWIO_BIMC_M_DSP_MPORT_BKE_HEALTH_2_ADDR A:0x6040c348
y.create.l HWIO_BIMC_M_DSP_MPORT_BKE_HEALTH_3_ADDR A:0x6040c34c
y.create.l HWIO_BIMC_M_DSP_MPORT_STATUS_2A_ADDR A:0x6040c420
y.create.l HWIO_BIMC_M_DSP_MPORT_STATUS_2B_ADDR A:0x6040c424
y.create.l HWIO_BIMC_M_DSP_MPORT_STATUS_3A_ADDR A:0x6040c430
y.create.l HWIO_BIMC_M_DSP_MPORT_STATUS_3B_ADDR A:0x6040c434
y.create.l HWIO_BIMC_M_DSP_MPORT_BKE1_ENABLE_ADDR A:0x6040c800
y.create.l HWIO_BIMC_M_DSP_MPORT_BKE1_GRANT_PERIOD_ADDR A:0x6040c804
y.create.l HWIO_BIMC_M_DSP_MPORT_BKE1_GRANT_COUNT_ADDR A:0x6040c808
y.create.l HWIO_BIMC_M_DSP_MPORT_BKE1_THRESHOLD_HIGH_ADDR A:0x6040c820
y.create.l HWIO_BIMC_M_DSP_MPORT_BKE1_THRESHOLD_MEDIUM_ADDR A:0x6040c824
y.create.l HWIO_BIMC_M_DSP_MPORT_BKE1_THRESHOLD_LOW_ADDR A:0x6040c828
y.create.l HWIO_BIMC_M_DSP_MPORT_BKE1_HEALTH_0_ADDR A:0x6040c840
y.create.l HWIO_BIMC_M_DSP_MPORT_BKE1_HEALTH_1_ADDR A:0x6040c844
y.create.l HWIO_BIMC_M_DSP_MPORT_BKE1_HEALTH_2_ADDR A:0x6040c848
y.create.l HWIO_BIMC_M_DSP_MPORT_BKE1_HEALTH_3_ADDR A:0x6040c84c
y.create.l HWIO_BIMC_M_DSP_MPORT_BKE2_ENABLE_ADDR A:0x6040c900
y.create.l HWIO_BIMC_M_DSP_MPORT_BKE2_GRANT_PERIOD_ADDR A:0x6040c904
y.create.l HWIO_BIMC_M_DSP_MPORT_BKE2_GRANT_COUNT_ADDR A:0x6040c908
y.create.l HWIO_BIMC_M_DSP_MPORT_BKE2_THRESHOLD_HIGH_ADDR A:0x6040c920
y.create.l HWIO_BIMC_M_DSP_MPORT_BKE2_THRESHOLD_MEDIUM_ADDR A:0x6040c924
y.create.l HWIO_BIMC_M_DSP_MPORT_BKE2_THRESHOLD_LOW_ADDR A:0x6040c928
y.create.l HWIO_BIMC_M_DSP_MPORT_BKE2_HEALTH_0_ADDR A:0x6040c940
y.create.l HWIO_BIMC_M_DSP_MPORT_BKE2_HEALTH_1_ADDR A:0x6040c944
y.create.l HWIO_BIMC_M_DSP_MPORT_BKE2_HEALTH_2_ADDR A:0x6040c948
y.create.l HWIO_BIMC_M_DSP_MPORT_BKE2_HEALTH_3_ADDR A:0x6040c94c
y.create.l HWIO_BIMC_M_DSP_MPORT_BKE3_ENABLE_ADDR A:0x6040ca00
y.create.l HWIO_BIMC_M_DSP_MPORT_BKE3_GRANT_PERIOD_ADDR A:0x6040ca04
y.create.l HWIO_BIMC_M_DSP_MPORT_BKE3_GRANT_COUNT_ADDR A:0x6040ca08
y.create.l HWIO_BIMC_M_DSP_MPORT_BKE3_THRESHOLD_HIGH_ADDR A:0x6040ca20
y.create.l HWIO_BIMC_M_DSP_MPORT_BKE3_THRESHOLD_MEDIUM_ADDR A:0x6040ca24
y.create.l HWIO_BIMC_M_DSP_MPORT_BKE3_THRESHOLD_LOW_ADDR A:0x6040ca28
y.create.l HWIO_BIMC_M_DSP_MPORT_BKE3_HEALTH_0_ADDR A:0x6040ca40
y.create.l HWIO_BIMC_M_DSP_MPORT_BKE3_HEALTH_1_ADDR A:0x6040ca44
y.create.l HWIO_BIMC_M_DSP_MPORT_BKE3_HEALTH_2_ADDR A:0x6040ca48
y.create.l HWIO_BIMC_M_DSP_MPORT_BKE3_HEALTH_3_ADDR A:0x6040ca4c
y.create.l HWIO_BIMC_M_DSP_PROF_COMPONENT_INFO_ADDR A:0x6040d000
y.create.l HWIO_BIMC_M_DSP_PROF_CONFIGURATION_INFO_0_ADDR A:0x6040d020
y.create.l HWIO_BIMC_M_DSP_PROF_CONFIGURATION_INFO_1_ADDR A:0x6040d030
y.create.l HWIO_BIMC_M_DSP_PROF_CLOCK_CTRL_ADDR A:0x6040d200
y.create.l HWIO_BIMC_M_DSP_PROF_MODE_ADDR A:0x6040d210
y.create.l HWIO_BIMC_M_DSP_PROF_RD_TENURE_THRESHOLD_ADDR A:0x6040d214
y.create.l HWIO_BIMC_M_DSP_PROF_WR_TENURE_THRESHOLD_ADDR A:0x6040d218
y.create.l HWIO_BIMC_M_DSP_PROF_SWAY_SELECT_ADDR A:0x6040d220
y.create.l HWIO_BIMC_M_DSP_PROF_MID_MASK_ADDR A:0x6040d230
y.create.l HWIO_BIMC_M_DSP_PROF_MID_MATCH_ADDR A:0x6040d234
y.create.l HWIO_BIMC_M_DSP_PROF_MID_INV_MATCH_ADDR A:0x6040d238
y.create.l HWIO_BIMC_M_DSP_PROF_ADDR_MASK_LOWER_ADDR A:0x6040d240
y.create.l HWIO_BIMC_M_DSP_PROF_ADDR_MASK_UPPER_ADDR A:0x6040d244
y.create.l HWIO_BIMC_M_DSP_PROF_ADDR_MATCH_LOWER_ADDR A:0x6040d248
y.create.l HWIO_BIMC_M_DSP_PROF_ADDR_MATCH_UPPER_ADDR A:0x6040d24c
y.create.l HWIO_BIMC_M_DSP_PROF_ADDR_INV_MATCH_ADDR A:0x6040d250
y.create.l HWIO_BIMC_M_DSP_PROF_ACH_MASK_0_ADDR A:0x6040d260
y.create.l HWIO_BIMC_M_DSP_PROF_ACH_MATCH_0_ADDR A:0x6040d264
y.create.l HWIO_BIMC_M_DSP_PROF_ACH_MASK_1_ADDR A:0x6040d270
y.create.l HWIO_BIMC_M_DSP_PROF_ACH_MATCH_1_ADDR A:0x6040d274
y.create.l HWIO_BIMC_M_DSP_PROF_ACH_INV_MATCH_1_ADDR A:0x6040d278
y.create.l HWIO_BIMC_M_DSP_PROF_ACH_MASK_2_ADDR A:0x6040d280
y.create.l HWIO_BIMC_M_DSP_PROF_ACH_MATCH_2_ADDR A:0x6040d284
y.create.l HWIO_BIMC_M_DSP_PROF_ACH_MASK_3_ADDR A:0x6040d290
y.create.l HWIO_BIMC_M_DSP_PROF_ACH_MATCH_3_ADDR A:0x6040d294
y.create.l HWIO_BIMC_M_DSP_PROF_ACH_INV_MATCH_3_ADDR A:0x6040d298
y.create.l HWIO_BIMC_M_DSP_PROF_ACH_MASK_4_ADDR A:0x6040d2a0
y.create.l HWIO_BIMC_M_DSP_PROF_ACH_MATCH_4_ADDR A:0x6040d2a4
y.create.l HWIO_BIMC_M_DSP_PROF_ACH_INV_MATCH_4_ADDR A:0x6040d2a8
y.create.l HWIO_BIMC_M_DSP_PROF_BCH_MASK_ADDR A:0x6040d300
y.create.l HWIO_BIMC_M_DSP_PROF_BCH_MATCH_ADDR A:0x6040d304
y.create.l HWIO_BIMC_M_DSP_PROF_BCH_INV_MATCH_ADDR A:0x6040d308
y.create.l HWIO_BIMC_M_DSP_PROF_RCH_MASK_ADDR A:0x6040d340
y.create.l HWIO_BIMC_M_DSP_PROF_RCH_MATCH_ADDR A:0x6040d344
y.create.l HWIO_BIMC_M_DSP_PROF_RCH_INV_MATCH_ADDR A:0x6040d348
y.create.l HWIO_BIMC_M_DSP_PROF_RD_STATUS_0_ADDR A:0x6040d400
y.create.l HWIO_BIMC_M_DSP_PROF_WR_STATUS_0_ADDR A:0x6040d410
y.create.l HWIO_BIMC_M_GPU_MPORT_COMPONENT_INFO_ADDR A:0x60410000
y.create.l HWIO_BIMC_M_GPU_MPORT_CONFIGURATION_INFO_0_ADDR A:0x60410020
y.create.l HWIO_BIMC_M_GPU_MPORT_CONFIGURATION_INFO_1_ADDR A:0x60410030
y.create.l HWIO_BIMC_M_GPU_MPORT_CONFIGURATION_INFO_2A_ADDR A:0x60410040
y.create.l HWIO_BIMC_M_GPU_MPORT_CONFIGURATION_INFO_2B_ADDR A:0x60410044
y.create.l HWIO_BIMC_M_GPU_MPORT_CONFIGURATION_INFO_3_ADDR A:0x60410050
y.create.l HWIO_BIMC_M_GPU_MPORT_CONFIGURATION_INFO_4_ADDR A:0x60410060
y.create.l HWIO_BIMC_M_GPU_MPORT_CONFIGURATION_INFO_5A_ADDR A:0x60410070
y.create.l HWIO_BIMC_M_GPU_MPORT_CONFIGURATION_INFO_5B_ADDR A:0x60410074
y.create.l HWIO_BIMC_M_GPU_MPORT_CONFIGURATION_INFO_5C_ADDR A:0x60410078
y.create.l HWIO_BIMC_M_GPU_MPORT_CONFIGURATION_INFO_5D_ADDR A:0x6041007c
y.create.l HWIO_BIMC_M_GPU_MPORT_INTERRUPT_STATUS_ADDR A:0x60410100
y.create.l HWIO_BIMC_M_GPU_MPORT_INTERRUPT_CLEAR_ADDR A:0x60410108
y.create.l HWIO_BIMC_M_GPU_MPORT_INTERRUPT_ENABLE_ADDR A:0x6041010c
y.create.l HWIO_BIMC_M_GPU_MPORT_CLOCK_CTRL_ADDR A:0x60410200
y.create.l HWIO_BIMC_M_GPU_MPORT_CDC_CTRL_ADDR A:0x60410208
y.create.l HWIO_BIMC_M_GPU_MPORT_MODE_ADDR A:0x60410210
y.create.l HWIO_BIMC_M_GPU_MPORT_WR_WAY_CROSSING_ADDR A:0x60410220
y.create.l HWIO_BIMC_M_GPU_MPORT_PRIORITYLVL_OVERRIDE_ADDR A:0x60410230
y.create.l HWIO_BIMC_M_GPU_MPORT_READ_COMMAND_OVERRIDE_ADDR A:0x60410240
y.create.l HWIO_BIMC_M_GPU_MPORT_WRITE_COMMAND_OVERRIDE_ADDR A:0x60410250
y.create.l HWIO_BIMC_M_GPU_MPORT_RD_TRACKING_INDEX_ADDR A:0x60410270
y.create.l HWIO_BIMC_M_GPU_MPORT_WR_TRACKING_INDEX_ADDR A:0x60410274
y.create.l HWIO_BIMC_M_GPU_MPORT_BWMON_ENABLE_ADDR A:0x60410280
y.create.l HWIO_BIMC_M_GPU_MPORT_BWMON_CLEAR_ADDR A:0x60410284
y.create.l HWIO_BIMC_M_GPU_MPORT_BWMON_BYTE_COUNT_ADDR A:0x60410288
y.create.l HWIO_BIMC_M_GPU_MPORT_BWMON_THRESHOLD_ADDR A:0x60410290
y.create.l HWIO_BIMC_M_GPU_MPORT_BWMON_MID_MASK_ADDR A:0x60410298
y.create.l HWIO_BIMC_M_GPU_MPORT_BWMON_MID_MATCH_ADDR A:0x6041029c
y.create.l HWIO_BIMC_M_GPU_MPORT_BKE_ENABLE_ADDR A:0x60410300
y.create.l HWIO_BIMC_M_GPU_MPORT_BKE_GRANT_PERIOD_ADDR A:0x60410304
y.create.l HWIO_BIMC_M_GPU_MPORT_BKE_GRANT_COUNT_ADDR A:0x60410308
y.create.l HWIO_BIMC_M_GPU_MPORT_BKE_THRESHOLD_HIGH_ADDR A:0x60410320
y.create.l HWIO_BIMC_M_GPU_MPORT_BKE_THRESHOLD_MEDIUM_ADDR A:0x60410324
y.create.l HWIO_BIMC_M_GPU_MPORT_BKE_THRESHOLD_LOW_ADDR A:0x60410328
y.create.l HWIO_BIMC_M_GPU_MPORT_BKE_HEALTH_0_ADDR A:0x60410340
y.create.l HWIO_BIMC_M_GPU_MPORT_BKE_HEALTH_1_ADDR A:0x60410344
y.create.l HWIO_BIMC_M_GPU_MPORT_BKE_HEALTH_2_ADDR A:0x60410348
y.create.l HWIO_BIMC_M_GPU_MPORT_BKE_HEALTH_3_ADDR A:0x6041034c
y.create.l HWIO_BIMC_M_GPU_MPORT_STATUS_2A_ADDR A:0x60410420
y.create.l HWIO_BIMC_M_GPU_MPORT_STATUS_2B_ADDR A:0x60410424
y.create.l HWIO_BIMC_M_GPU_MPORT_STATUS_3A_ADDR A:0x60410430
y.create.l HWIO_BIMC_M_GPU_MPORT_STATUS_3B_ADDR A:0x60410434
y.create.l HWIO_BIMC_M_GPU_MPORT_BKE1_ENABLE_ADDR A:0x60410800
y.create.l HWIO_BIMC_M_GPU_MPORT_BKE1_GRANT_PERIOD_ADDR A:0x60410804
y.create.l HWIO_BIMC_M_GPU_MPORT_BKE1_GRANT_COUNT_ADDR A:0x60410808
y.create.l HWIO_BIMC_M_GPU_MPORT_BKE1_THRESHOLD_HIGH_ADDR A:0x60410820
y.create.l HWIO_BIMC_M_GPU_MPORT_BKE1_THRESHOLD_MEDIUM_ADDR A:0x60410824
y.create.l HWIO_BIMC_M_GPU_MPORT_BKE1_THRESHOLD_LOW_ADDR A:0x60410828
y.create.l HWIO_BIMC_M_GPU_MPORT_BKE1_HEALTH_0_ADDR A:0x60410840
y.create.l HWIO_BIMC_M_GPU_MPORT_BKE1_HEALTH_1_ADDR A:0x60410844
y.create.l HWIO_BIMC_M_GPU_MPORT_BKE1_HEALTH_2_ADDR A:0x60410848
y.create.l HWIO_BIMC_M_GPU_MPORT_BKE1_HEALTH_3_ADDR A:0x6041084c
y.create.l HWIO_BIMC_M_GPU_MPORT_BKE2_ENABLE_ADDR A:0x60410900
y.create.l HWIO_BIMC_M_GPU_MPORT_BKE2_GRANT_PERIOD_ADDR A:0x60410904
y.create.l HWIO_BIMC_M_GPU_MPORT_BKE2_GRANT_COUNT_ADDR A:0x60410908
y.create.l HWIO_BIMC_M_GPU_MPORT_BKE2_THRESHOLD_HIGH_ADDR A:0x60410920
y.create.l HWIO_BIMC_M_GPU_MPORT_BKE2_THRESHOLD_MEDIUM_ADDR A:0x60410924
y.create.l HWIO_BIMC_M_GPU_MPORT_BKE2_THRESHOLD_LOW_ADDR A:0x60410928
y.create.l HWIO_BIMC_M_GPU_MPORT_BKE2_HEALTH_0_ADDR A:0x60410940
y.create.l HWIO_BIMC_M_GPU_MPORT_BKE2_HEALTH_1_ADDR A:0x60410944
y.create.l HWIO_BIMC_M_GPU_MPORT_BKE2_HEALTH_2_ADDR A:0x60410948
y.create.l HWIO_BIMC_M_GPU_MPORT_BKE2_HEALTH_3_ADDR A:0x6041094c
y.create.l HWIO_BIMC_M_GPU_MPORT_BKE3_ENABLE_ADDR A:0x60410a00
y.create.l HWIO_BIMC_M_GPU_MPORT_BKE3_GRANT_PERIOD_ADDR A:0x60410a04
y.create.l HWIO_BIMC_M_GPU_MPORT_BKE3_GRANT_COUNT_ADDR A:0x60410a08
y.create.l HWIO_BIMC_M_GPU_MPORT_BKE3_THRESHOLD_HIGH_ADDR A:0x60410a20
y.create.l HWIO_BIMC_M_GPU_MPORT_BKE3_THRESHOLD_MEDIUM_ADDR A:0x60410a24
y.create.l HWIO_BIMC_M_GPU_MPORT_BKE3_THRESHOLD_LOW_ADDR A:0x60410a28
y.create.l HWIO_BIMC_M_GPU_MPORT_BKE3_HEALTH_0_ADDR A:0x60410a40
y.create.l HWIO_BIMC_M_GPU_MPORT_BKE3_HEALTH_1_ADDR A:0x60410a44
y.create.l HWIO_BIMC_M_GPU_MPORT_BKE3_HEALTH_2_ADDR A:0x60410a48
y.create.l HWIO_BIMC_M_GPU_MPORT_BKE3_HEALTH_3_ADDR A:0x60410a4c
y.create.l HWIO_BIMC_M_GPU_PROF_COMPONENT_INFO_ADDR A:0x60411000
y.create.l HWIO_BIMC_M_GPU_PROF_CONFIGURATION_INFO_0_ADDR A:0x60411020
y.create.l HWIO_BIMC_M_GPU_PROF_CONFIGURATION_INFO_1_ADDR A:0x60411030
y.create.l HWIO_BIMC_M_GPU_PROF_CLOCK_CTRL_ADDR A:0x60411200
y.create.l HWIO_BIMC_M_GPU_PROF_MODE_ADDR A:0x60411210
y.create.l HWIO_BIMC_M_GPU_PROF_RD_TENURE_THRESHOLD_ADDR A:0x60411214
y.create.l HWIO_BIMC_M_GPU_PROF_WR_TENURE_THRESHOLD_ADDR A:0x60411218
y.create.l HWIO_BIMC_M_GPU_PROF_SWAY_SELECT_ADDR A:0x60411220
y.create.l HWIO_BIMC_M_GPU_PROF_MID_MASK_ADDR A:0x60411230
y.create.l HWIO_BIMC_M_GPU_PROF_MID_MATCH_ADDR A:0x60411234
y.create.l HWIO_BIMC_M_GPU_PROF_MID_INV_MATCH_ADDR A:0x60411238
y.create.l HWIO_BIMC_M_GPU_PROF_ADDR_MASK_LOWER_ADDR A:0x60411240
y.create.l HWIO_BIMC_M_GPU_PROF_ADDR_MASK_UPPER_ADDR A:0x60411244
y.create.l HWIO_BIMC_M_GPU_PROF_ADDR_MATCH_LOWER_ADDR A:0x60411248
y.create.l HWIO_BIMC_M_GPU_PROF_ADDR_MATCH_UPPER_ADDR A:0x6041124c
y.create.l HWIO_BIMC_M_GPU_PROF_ADDR_INV_MATCH_ADDR A:0x60411250
y.create.l HWIO_BIMC_M_GPU_PROF_ACH_MASK_0_ADDR A:0x60411260
y.create.l HWIO_BIMC_M_GPU_PROF_ACH_MATCH_0_ADDR A:0x60411264
y.create.l HWIO_BIMC_M_GPU_PROF_ACH_MASK_1_ADDR A:0x60411270
y.create.l HWIO_BIMC_M_GPU_PROF_ACH_MATCH_1_ADDR A:0x60411274
y.create.l HWIO_BIMC_M_GPU_PROF_ACH_INV_MATCH_1_ADDR A:0x60411278
y.create.l HWIO_BIMC_M_GPU_PROF_ACH_MASK_2_ADDR A:0x60411280
y.create.l HWIO_BIMC_M_GPU_PROF_ACH_MATCH_2_ADDR A:0x60411284
y.create.l HWIO_BIMC_M_GPU_PROF_ACH_MASK_3_ADDR A:0x60411290
y.create.l HWIO_BIMC_M_GPU_PROF_ACH_MATCH_3_ADDR A:0x60411294
y.create.l HWIO_BIMC_M_GPU_PROF_ACH_INV_MATCH_3_ADDR A:0x60411298
y.create.l HWIO_BIMC_M_GPU_PROF_ACH_MASK_4_ADDR A:0x604112a0
y.create.l HWIO_BIMC_M_GPU_PROF_ACH_MATCH_4_ADDR A:0x604112a4
y.create.l HWIO_BIMC_M_GPU_PROF_ACH_INV_MATCH_4_ADDR A:0x604112a8
y.create.l HWIO_BIMC_M_GPU_PROF_BCH_MASK_ADDR A:0x60411300
y.create.l HWIO_BIMC_M_GPU_PROF_BCH_MATCH_ADDR A:0x60411304
y.create.l HWIO_BIMC_M_GPU_PROF_BCH_INV_MATCH_ADDR A:0x60411308
y.create.l HWIO_BIMC_M_GPU_PROF_RCH_MASK_ADDR A:0x60411340
y.create.l HWIO_BIMC_M_GPU_PROF_RCH_MATCH_ADDR A:0x60411344
y.create.l HWIO_BIMC_M_GPU_PROF_RCH_INV_MATCH_ADDR A:0x60411348
y.create.l HWIO_BIMC_M_GPU_PROF_RD_STATUS_0_ADDR A:0x60411400
y.create.l HWIO_BIMC_M_GPU_PROF_WR_STATUS_0_ADDR A:0x60411410
y.create.l HWIO_BIMC_M_SYS0_MPORT_COMPONENT_INFO_ADDR A:0x60414000
y.create.l HWIO_BIMC_M_SYS0_MPORT_CONFIGURATION_INFO_0_ADDR A:0x60414020
y.create.l HWIO_BIMC_M_SYS0_MPORT_CONFIGURATION_INFO_1_ADDR A:0x60414030
y.create.l HWIO_BIMC_M_SYS0_MPORT_CONFIGURATION_INFO_2A_ADDR A:0x60414040
y.create.l HWIO_BIMC_M_SYS0_MPORT_CONFIGURATION_INFO_2B_ADDR A:0x60414044
y.create.l HWIO_BIMC_M_SYS0_MPORT_CONFIGURATION_INFO_3_ADDR A:0x60414050
y.create.l HWIO_BIMC_M_SYS0_MPORT_CONFIGURATION_INFO_4_ADDR A:0x60414060
y.create.l HWIO_BIMC_M_SYS0_MPORT_CONFIGURATION_INFO_5A_ADDR A:0x60414070
y.create.l HWIO_BIMC_M_SYS0_MPORT_CONFIGURATION_INFO_5B_ADDR A:0x60414074
y.create.l HWIO_BIMC_M_SYS0_MPORT_CONFIGURATION_INFO_5C_ADDR A:0x60414078
y.create.l HWIO_BIMC_M_SYS0_MPORT_CONFIGURATION_INFO_5D_ADDR A:0x6041407c
y.create.l HWIO_BIMC_M_SYS0_MPORT_INTERRUPT_STATUS_ADDR A:0x60414100
y.create.l HWIO_BIMC_M_SYS0_MPORT_INTERRUPT_CLEAR_ADDR A:0x60414108
y.create.l HWIO_BIMC_M_SYS0_MPORT_INTERRUPT_ENABLE_ADDR A:0x6041410c
y.create.l HWIO_BIMC_M_SYS0_MPORT_CLOCK_CTRL_ADDR A:0x60414200
y.create.l HWIO_BIMC_M_SYS0_MPORT_CDC_CTRL_ADDR A:0x60414208
y.create.l HWIO_BIMC_M_SYS0_MPORT_MODE_ADDR A:0x60414210
y.create.l HWIO_BIMC_M_SYS0_MPORT_WR_WAY_CROSSING_ADDR A:0x60414220
y.create.l HWIO_BIMC_M_SYS0_MPORT_PRIORITYLVL_OVERRIDE_ADDR A:0x60414230
y.create.l HWIO_BIMC_M_SYS0_MPORT_READ_COMMAND_OVERRIDE_ADDR A:0x60414240
y.create.l HWIO_BIMC_M_SYS0_MPORT_WRITE_COMMAND_OVERRIDE_ADDR A:0x60414250
y.create.l HWIO_BIMC_M_SYS0_MPORT_RD_TRACKING_INDEX_ADDR A:0x60414270
y.create.l HWIO_BIMC_M_SYS0_MPORT_WR_TRACKING_INDEX_ADDR A:0x60414274
y.create.l HWIO_BIMC_M_SYS0_MPORT_BWMON_ENABLE_ADDR A:0x60414280
y.create.l HWIO_BIMC_M_SYS0_MPORT_BWMON_CLEAR_ADDR A:0x60414284
y.create.l HWIO_BIMC_M_SYS0_MPORT_BWMON_BYTE_COUNT_ADDR A:0x60414288
y.create.l HWIO_BIMC_M_SYS0_MPORT_BWMON_THRESHOLD_ADDR A:0x60414290
y.create.l HWIO_BIMC_M_SYS0_MPORT_BWMON_MID_MASK_ADDR A:0x60414298
y.create.l HWIO_BIMC_M_SYS0_MPORT_BWMON_MID_MATCH_ADDR A:0x6041429c
y.create.l HWIO_BIMC_M_SYS0_MPORT_BKE_ENABLE_ADDR A:0x60414300
y.create.l HWIO_BIMC_M_SYS0_MPORT_BKE_GRANT_PERIOD_ADDR A:0x60414304
y.create.l HWIO_BIMC_M_SYS0_MPORT_BKE_GRANT_COUNT_ADDR A:0x60414308
y.create.l HWIO_BIMC_M_SYS0_MPORT_BKE_THRESHOLD_HIGH_ADDR A:0x60414320
y.create.l HWIO_BIMC_M_SYS0_MPORT_BKE_THRESHOLD_MEDIUM_ADDR A:0x60414324
y.create.l HWIO_BIMC_M_SYS0_MPORT_BKE_THRESHOLD_LOW_ADDR A:0x60414328
y.create.l HWIO_BIMC_M_SYS0_MPORT_BKE_HEALTH_0_ADDR A:0x60414340
y.create.l HWIO_BIMC_M_SYS0_MPORT_BKE_HEALTH_1_ADDR A:0x60414344
y.create.l HWIO_BIMC_M_SYS0_MPORT_BKE_HEALTH_2_ADDR A:0x60414348
y.create.l HWIO_BIMC_M_SYS0_MPORT_BKE_HEALTH_3_ADDR A:0x6041434c
y.create.l HWIO_BIMC_M_SYS0_MPORT_STATUS_2A_ADDR A:0x60414420
y.create.l HWIO_BIMC_M_SYS0_MPORT_STATUS_2B_ADDR A:0x60414424
y.create.l HWIO_BIMC_M_SYS0_MPORT_STATUS_3A_ADDR A:0x60414430
y.create.l HWIO_BIMC_M_SYS0_MPORT_STATUS_3B_ADDR A:0x60414434
y.create.l HWIO_BIMC_M_SYS0_MPORT_BKE1_ENABLE_ADDR A:0x60414800
y.create.l HWIO_BIMC_M_SYS0_MPORT_BKE1_GRANT_PERIOD_ADDR A:0x60414804
y.create.l HWIO_BIMC_M_SYS0_MPORT_BKE1_GRANT_COUNT_ADDR A:0x60414808
y.create.l HWIO_BIMC_M_SYS0_MPORT_BKE1_THRESHOLD_HIGH_ADDR A:0x60414820
y.create.l HWIO_BIMC_M_SYS0_MPORT_BKE1_THRESHOLD_MEDIUM_ADDR A:0x60414824
y.create.l HWIO_BIMC_M_SYS0_MPORT_BKE1_THRESHOLD_LOW_ADDR A:0x60414828
y.create.l HWIO_BIMC_M_SYS0_MPORT_BKE1_HEALTH_0_ADDR A:0x60414840
y.create.l HWIO_BIMC_M_SYS0_MPORT_BKE1_HEALTH_1_ADDR A:0x60414844
y.create.l HWIO_BIMC_M_SYS0_MPORT_BKE1_HEALTH_2_ADDR A:0x60414848
y.create.l HWIO_BIMC_M_SYS0_MPORT_BKE1_HEALTH_3_ADDR A:0x6041484c
y.create.l HWIO_BIMC_M_SYS0_MPORT_BKE2_ENABLE_ADDR A:0x60414900
y.create.l HWIO_BIMC_M_SYS0_MPORT_BKE2_GRANT_PERIOD_ADDR A:0x60414904
y.create.l HWIO_BIMC_M_SYS0_MPORT_BKE2_GRANT_COUNT_ADDR A:0x60414908
y.create.l HWIO_BIMC_M_SYS0_MPORT_BKE2_THRESHOLD_HIGH_ADDR A:0x60414920
y.create.l HWIO_BIMC_M_SYS0_MPORT_BKE2_THRESHOLD_MEDIUM_ADDR A:0x60414924
y.create.l HWIO_BIMC_M_SYS0_MPORT_BKE2_THRESHOLD_LOW_ADDR A:0x60414928
y.create.l HWIO_BIMC_M_SYS0_MPORT_BKE2_HEALTH_0_ADDR A:0x60414940
y.create.l HWIO_BIMC_M_SYS0_MPORT_BKE2_HEALTH_1_ADDR A:0x60414944
y.create.l HWIO_BIMC_M_SYS0_MPORT_BKE2_HEALTH_2_ADDR A:0x60414948
y.create.l HWIO_BIMC_M_SYS0_MPORT_BKE2_HEALTH_3_ADDR A:0x6041494c
y.create.l HWIO_BIMC_M_SYS0_MPORT_BKE3_ENABLE_ADDR A:0x60414a00
y.create.l HWIO_BIMC_M_SYS0_MPORT_BKE3_GRANT_PERIOD_ADDR A:0x60414a04
y.create.l HWIO_BIMC_M_SYS0_MPORT_BKE3_GRANT_COUNT_ADDR A:0x60414a08
y.create.l HWIO_BIMC_M_SYS0_MPORT_BKE3_THRESHOLD_HIGH_ADDR A:0x60414a20
y.create.l HWIO_BIMC_M_SYS0_MPORT_BKE3_THRESHOLD_MEDIUM_ADDR A:0x60414a24
y.create.l HWIO_BIMC_M_SYS0_MPORT_BKE3_THRESHOLD_LOW_ADDR A:0x60414a28
y.create.l HWIO_BIMC_M_SYS0_MPORT_BKE3_HEALTH_0_ADDR A:0x60414a40
y.create.l HWIO_BIMC_M_SYS0_MPORT_BKE3_HEALTH_1_ADDR A:0x60414a44
y.create.l HWIO_BIMC_M_SYS0_MPORT_BKE3_HEALTH_2_ADDR A:0x60414a48
y.create.l HWIO_BIMC_M_SYS0_MPORT_BKE3_HEALTH_3_ADDR A:0x60414a4c
y.create.l HWIO_BIMC_M_SYS0_PROF_COMPONENT_INFO_ADDR A:0x60415000
y.create.l HWIO_BIMC_M_SYS0_PROF_CONFIGURATION_INFO_0_ADDR A:0x60415020
y.create.l HWIO_BIMC_M_SYS0_PROF_CONFIGURATION_INFO_1_ADDR A:0x60415030
y.create.l HWIO_BIMC_M_SYS0_PROF_CLOCK_CTRL_ADDR A:0x60415200
y.create.l HWIO_BIMC_M_SYS0_PROF_MODE_ADDR A:0x60415210
y.create.l HWIO_BIMC_M_SYS0_PROF_RD_TENURE_THRESHOLD_ADDR A:0x60415214
y.create.l HWIO_BIMC_M_SYS0_PROF_WR_TENURE_THRESHOLD_ADDR A:0x60415218
y.create.l HWIO_BIMC_M_SYS0_PROF_SWAY_SELECT_ADDR A:0x60415220
y.create.l HWIO_BIMC_M_SYS0_PROF_MID_MASK_ADDR A:0x60415230
y.create.l HWIO_BIMC_M_SYS0_PROF_MID_MATCH_ADDR A:0x60415234
y.create.l HWIO_BIMC_M_SYS0_PROF_MID_INV_MATCH_ADDR A:0x60415238
y.create.l HWIO_BIMC_M_SYS0_PROF_ADDR_MASK_LOWER_ADDR A:0x60415240
y.create.l HWIO_BIMC_M_SYS0_PROF_ADDR_MASK_UPPER_ADDR A:0x60415244
y.create.l HWIO_BIMC_M_SYS0_PROF_ADDR_MATCH_LOWER_ADDR A:0x60415248
y.create.l HWIO_BIMC_M_SYS0_PROF_ADDR_MATCH_UPPER_ADDR A:0x6041524c
y.create.l HWIO_BIMC_M_SYS0_PROF_ADDR_INV_MATCH_ADDR A:0x60415250
y.create.l HWIO_BIMC_M_SYS0_PROF_ACH_MASK_0_ADDR A:0x60415260
y.create.l HWIO_BIMC_M_SYS0_PROF_ACH_MATCH_0_ADDR A:0x60415264
y.create.l HWIO_BIMC_M_SYS0_PROF_ACH_MASK_1_ADDR A:0x60415270
y.create.l HWIO_BIMC_M_SYS0_PROF_ACH_MATCH_1_ADDR A:0x60415274
y.create.l HWIO_BIMC_M_SYS0_PROF_ACH_INV_MATCH_1_ADDR A:0x60415278
y.create.l HWIO_BIMC_M_SYS0_PROF_ACH_MASK_2_ADDR A:0x60415280
y.create.l HWIO_BIMC_M_SYS0_PROF_ACH_MATCH_2_ADDR A:0x60415284
y.create.l HWIO_BIMC_M_SYS0_PROF_ACH_MASK_3_ADDR A:0x60415290
y.create.l HWIO_BIMC_M_SYS0_PROF_ACH_MATCH_3_ADDR A:0x60415294
y.create.l HWIO_BIMC_M_SYS0_PROF_ACH_INV_MATCH_3_ADDR A:0x60415298
y.create.l HWIO_BIMC_M_SYS0_PROF_ACH_MASK_4_ADDR A:0x604152a0
y.create.l HWIO_BIMC_M_SYS0_PROF_ACH_MATCH_4_ADDR A:0x604152a4
y.create.l HWIO_BIMC_M_SYS0_PROF_ACH_INV_MATCH_4_ADDR A:0x604152a8
y.create.l HWIO_BIMC_M_SYS0_PROF_BCH_MASK_ADDR A:0x60415300
y.create.l HWIO_BIMC_M_SYS0_PROF_BCH_MATCH_ADDR A:0x60415304
y.create.l HWIO_BIMC_M_SYS0_PROF_BCH_INV_MATCH_ADDR A:0x60415308
y.create.l HWIO_BIMC_M_SYS0_PROF_RCH_MASK_ADDR A:0x60415340
y.create.l HWIO_BIMC_M_SYS0_PROF_RCH_MATCH_ADDR A:0x60415344
y.create.l HWIO_BIMC_M_SYS0_PROF_RCH_INV_MATCH_ADDR A:0x60415348
y.create.l HWIO_BIMC_M_SYS0_PROF_RD_STATUS_0_ADDR A:0x60415400
y.create.l HWIO_BIMC_M_SYS0_PROF_WR_STATUS_0_ADDR A:0x60415410
y.create.l HWIO_BIMC_M_SYS1_MPORT_COMPONENT_INFO_ADDR A:0x60418000
y.create.l HWIO_BIMC_M_SYS1_MPORT_CONFIGURATION_INFO_0_ADDR A:0x60418020
y.create.l HWIO_BIMC_M_SYS1_MPORT_CONFIGURATION_INFO_1_ADDR A:0x60418030
y.create.l HWIO_BIMC_M_SYS1_MPORT_CONFIGURATION_INFO_2A_ADDR A:0x60418040
y.create.l HWIO_BIMC_M_SYS1_MPORT_CONFIGURATION_INFO_2B_ADDR A:0x60418044
y.create.l HWIO_BIMC_M_SYS1_MPORT_CONFIGURATION_INFO_3_ADDR A:0x60418050
y.create.l HWIO_BIMC_M_SYS1_MPORT_CONFIGURATION_INFO_4_ADDR A:0x60418060
y.create.l HWIO_BIMC_M_SYS1_MPORT_CONFIGURATION_INFO_5A_ADDR A:0x60418070
y.create.l HWIO_BIMC_M_SYS1_MPORT_CONFIGURATION_INFO_5B_ADDR A:0x60418074
y.create.l HWIO_BIMC_M_SYS1_MPORT_CONFIGURATION_INFO_5C_ADDR A:0x60418078
y.create.l HWIO_BIMC_M_SYS1_MPORT_CONFIGURATION_INFO_5D_ADDR A:0x6041807c
y.create.l HWIO_BIMC_M_SYS1_MPORT_INTERRUPT_STATUS_ADDR A:0x60418100
y.create.l HWIO_BIMC_M_SYS1_MPORT_INTERRUPT_CLEAR_ADDR A:0x60418108
y.create.l HWIO_BIMC_M_SYS1_MPORT_INTERRUPT_ENABLE_ADDR A:0x6041810c
y.create.l HWIO_BIMC_M_SYS1_MPORT_CLOCK_CTRL_ADDR A:0x60418200
y.create.l HWIO_BIMC_M_SYS1_MPORT_CDC_CTRL_ADDR A:0x60418208
y.create.l HWIO_BIMC_M_SYS1_MPORT_MODE_ADDR A:0x60418210
y.create.l HWIO_BIMC_M_SYS1_MPORT_WR_WAY_CROSSING_ADDR A:0x60418220
y.create.l HWIO_BIMC_M_SYS1_MPORT_PRIORITYLVL_OVERRIDE_ADDR A:0x60418230
y.create.l HWIO_BIMC_M_SYS1_MPORT_READ_COMMAND_OVERRIDE_ADDR A:0x60418240
y.create.l HWIO_BIMC_M_SYS1_MPORT_WRITE_COMMAND_OVERRIDE_ADDR A:0x60418250
y.create.l HWIO_BIMC_M_SYS1_MPORT_RD_TRACKING_INDEX_ADDR A:0x60418270
y.create.l HWIO_BIMC_M_SYS1_MPORT_WR_TRACKING_INDEX_ADDR A:0x60418274
y.create.l HWIO_BIMC_M_SYS1_MPORT_BWMON_ENABLE_ADDR A:0x60418280
y.create.l HWIO_BIMC_M_SYS1_MPORT_BWMON_CLEAR_ADDR A:0x60418284
y.create.l HWIO_BIMC_M_SYS1_MPORT_BWMON_BYTE_COUNT_ADDR A:0x60418288
y.create.l HWIO_BIMC_M_SYS1_MPORT_BWMON_THRESHOLD_ADDR A:0x60418290
y.create.l HWIO_BIMC_M_SYS1_MPORT_BWMON_MID_MASK_ADDR A:0x60418298
y.create.l HWIO_BIMC_M_SYS1_MPORT_BWMON_MID_MATCH_ADDR A:0x6041829c
y.create.l HWIO_BIMC_M_SYS1_MPORT_BKE_ENABLE_ADDR A:0x60418300
y.create.l HWIO_BIMC_M_SYS1_MPORT_BKE_GRANT_PERIOD_ADDR A:0x60418304
y.create.l HWIO_BIMC_M_SYS1_MPORT_BKE_GRANT_COUNT_ADDR A:0x60418308
y.create.l HWIO_BIMC_M_SYS1_MPORT_BKE_THRESHOLD_HIGH_ADDR A:0x60418320
y.create.l HWIO_BIMC_M_SYS1_MPORT_BKE_THRESHOLD_MEDIUM_ADDR A:0x60418324
y.create.l HWIO_BIMC_M_SYS1_MPORT_BKE_THRESHOLD_LOW_ADDR A:0x60418328
y.create.l HWIO_BIMC_M_SYS1_MPORT_BKE_HEALTH_0_ADDR A:0x60418340
y.create.l HWIO_BIMC_M_SYS1_MPORT_BKE_HEALTH_1_ADDR A:0x60418344
y.create.l HWIO_BIMC_M_SYS1_MPORT_BKE_HEALTH_2_ADDR A:0x60418348
y.create.l HWIO_BIMC_M_SYS1_MPORT_BKE_HEALTH_3_ADDR A:0x6041834c
y.create.l HWIO_BIMC_M_SYS1_MPORT_STATUS_2A_ADDR A:0x60418420
y.create.l HWIO_BIMC_M_SYS1_MPORT_STATUS_2B_ADDR A:0x60418424
y.create.l HWIO_BIMC_M_SYS1_MPORT_STATUS_3A_ADDR A:0x60418430
y.create.l HWIO_BIMC_M_SYS1_MPORT_STATUS_3B_ADDR A:0x60418434
y.create.l HWIO_BIMC_M_SYS1_MPORT_BKE1_ENABLE_ADDR A:0x60418800
y.create.l HWIO_BIMC_M_SYS1_MPORT_BKE1_GRANT_PERIOD_ADDR A:0x60418804
y.create.l HWIO_BIMC_M_SYS1_MPORT_BKE1_GRANT_COUNT_ADDR A:0x60418808
y.create.l HWIO_BIMC_M_SYS1_MPORT_BKE1_THRESHOLD_HIGH_ADDR A:0x60418820
y.create.l HWIO_BIMC_M_SYS1_MPORT_BKE1_THRESHOLD_MEDIUM_ADDR A:0x60418824
y.create.l HWIO_BIMC_M_SYS1_MPORT_BKE1_THRESHOLD_LOW_ADDR A:0x60418828
y.create.l HWIO_BIMC_M_SYS1_MPORT_BKE1_HEALTH_0_ADDR A:0x60418840
y.create.l HWIO_BIMC_M_SYS1_MPORT_BKE1_HEALTH_1_ADDR A:0x60418844
y.create.l HWIO_BIMC_M_SYS1_MPORT_BKE1_HEALTH_2_ADDR A:0x60418848
y.create.l HWIO_BIMC_M_SYS1_MPORT_BKE1_HEALTH_3_ADDR A:0x6041884c
y.create.l HWIO_BIMC_M_SYS1_MPORT_BKE2_ENABLE_ADDR A:0x60418900
y.create.l HWIO_BIMC_M_SYS1_MPORT_BKE2_GRANT_PERIOD_ADDR A:0x60418904
y.create.l HWIO_BIMC_M_SYS1_MPORT_BKE2_GRANT_COUNT_ADDR A:0x60418908
y.create.l HWIO_BIMC_M_SYS1_MPORT_BKE2_THRESHOLD_HIGH_ADDR A:0x60418920
y.create.l HWIO_BIMC_M_SYS1_MPORT_BKE2_THRESHOLD_MEDIUM_ADDR A:0x60418924
y.create.l HWIO_BIMC_M_SYS1_MPORT_BKE2_THRESHOLD_LOW_ADDR A:0x60418928
y.create.l HWIO_BIMC_M_SYS1_MPORT_BKE2_HEALTH_0_ADDR A:0x60418940
y.create.l HWIO_BIMC_M_SYS1_MPORT_BKE2_HEALTH_1_ADDR A:0x60418944
y.create.l HWIO_BIMC_M_SYS1_MPORT_BKE2_HEALTH_2_ADDR A:0x60418948
y.create.l HWIO_BIMC_M_SYS1_MPORT_BKE2_HEALTH_3_ADDR A:0x6041894c
y.create.l HWIO_BIMC_M_SYS1_MPORT_BKE3_ENABLE_ADDR A:0x60418a00
y.create.l HWIO_BIMC_M_SYS1_MPORT_BKE3_GRANT_PERIOD_ADDR A:0x60418a04
y.create.l HWIO_BIMC_M_SYS1_MPORT_BKE3_GRANT_COUNT_ADDR A:0x60418a08
y.create.l HWIO_BIMC_M_SYS1_MPORT_BKE3_THRESHOLD_HIGH_ADDR A:0x60418a20
y.create.l HWIO_BIMC_M_SYS1_MPORT_BKE3_THRESHOLD_MEDIUM_ADDR A:0x60418a24
y.create.l HWIO_BIMC_M_SYS1_MPORT_BKE3_THRESHOLD_LOW_ADDR A:0x60418a28
y.create.l HWIO_BIMC_M_SYS1_MPORT_BKE3_HEALTH_0_ADDR A:0x60418a40
y.create.l HWIO_BIMC_M_SYS1_MPORT_BKE3_HEALTH_1_ADDR A:0x60418a44
y.create.l HWIO_BIMC_M_SYS1_MPORT_BKE3_HEALTH_2_ADDR A:0x60418a48
y.create.l HWIO_BIMC_M_SYS1_MPORT_BKE3_HEALTH_3_ADDR A:0x60418a4c
y.create.l HWIO_BIMC_M_SYS1_PROF_COMPONENT_INFO_ADDR A:0x60419000
y.create.l HWIO_BIMC_M_SYS1_PROF_CONFIGURATION_INFO_0_ADDR A:0x60419020
y.create.l HWIO_BIMC_M_SYS1_PROF_CONFIGURATION_INFO_1_ADDR A:0x60419030
y.create.l HWIO_BIMC_M_SYS1_PROF_CLOCK_CTRL_ADDR A:0x60419200
y.create.l HWIO_BIMC_M_SYS1_PROF_MODE_ADDR A:0x60419210
y.create.l HWIO_BIMC_M_SYS1_PROF_RD_TENURE_THRESHOLD_ADDR A:0x60419214
y.create.l HWIO_BIMC_M_SYS1_PROF_WR_TENURE_THRESHOLD_ADDR A:0x60419218
y.create.l HWIO_BIMC_M_SYS1_PROF_SWAY_SELECT_ADDR A:0x60419220
y.create.l HWIO_BIMC_M_SYS1_PROF_MID_MASK_ADDR A:0x60419230
y.create.l HWIO_BIMC_M_SYS1_PROF_MID_MATCH_ADDR A:0x60419234
y.create.l HWIO_BIMC_M_SYS1_PROF_MID_INV_MATCH_ADDR A:0x60419238
y.create.l HWIO_BIMC_M_SYS1_PROF_ADDR_MASK_LOWER_ADDR A:0x60419240
y.create.l HWIO_BIMC_M_SYS1_PROF_ADDR_MASK_UPPER_ADDR A:0x60419244
y.create.l HWIO_BIMC_M_SYS1_PROF_ADDR_MATCH_LOWER_ADDR A:0x60419248
y.create.l HWIO_BIMC_M_SYS1_PROF_ADDR_MATCH_UPPER_ADDR A:0x6041924c
y.create.l HWIO_BIMC_M_SYS1_PROF_ADDR_INV_MATCH_ADDR A:0x60419250
y.create.l HWIO_BIMC_M_SYS1_PROF_ACH_MASK_0_ADDR A:0x60419260
y.create.l HWIO_BIMC_M_SYS1_PROF_ACH_MATCH_0_ADDR A:0x60419264
y.create.l HWIO_BIMC_M_SYS1_PROF_ACH_MASK_1_ADDR A:0x60419270
y.create.l HWIO_BIMC_M_SYS1_PROF_ACH_MATCH_1_ADDR A:0x60419274
y.create.l HWIO_BIMC_M_SYS1_PROF_ACH_INV_MATCH_1_ADDR A:0x60419278
y.create.l HWIO_BIMC_M_SYS1_PROF_ACH_MASK_2_ADDR A:0x60419280
y.create.l HWIO_BIMC_M_SYS1_PROF_ACH_MATCH_2_ADDR A:0x60419284
y.create.l HWIO_BIMC_M_SYS1_PROF_ACH_MASK_3_ADDR A:0x60419290
y.create.l HWIO_BIMC_M_SYS1_PROF_ACH_MATCH_3_ADDR A:0x60419294
y.create.l HWIO_BIMC_M_SYS1_PROF_ACH_INV_MATCH_3_ADDR A:0x60419298
y.create.l HWIO_BIMC_M_SYS1_PROF_ACH_MASK_4_ADDR A:0x604192a0
y.create.l HWIO_BIMC_M_SYS1_PROF_ACH_MATCH_4_ADDR A:0x604192a4
y.create.l HWIO_BIMC_M_SYS1_PROF_ACH_INV_MATCH_4_ADDR A:0x604192a8
y.create.l HWIO_BIMC_M_SYS1_PROF_BCH_MASK_ADDR A:0x60419300
y.create.l HWIO_BIMC_M_SYS1_PROF_BCH_MATCH_ADDR A:0x60419304
y.create.l HWIO_BIMC_M_SYS1_PROF_BCH_INV_MATCH_ADDR A:0x60419308
y.create.l HWIO_BIMC_M_SYS1_PROF_RCH_MASK_ADDR A:0x60419340
y.create.l HWIO_BIMC_M_SYS1_PROF_RCH_MATCH_ADDR A:0x60419344
y.create.l HWIO_BIMC_M_SYS1_PROF_RCH_INV_MATCH_ADDR A:0x60419348
y.create.l HWIO_BIMC_M_SYS1_PROF_RD_STATUS_0_ADDR A:0x60419400
y.create.l HWIO_BIMC_M_SYS1_PROF_WR_STATUS_0_ADDR A:0x60419410
y.create.l HWIO_BIMC_M_TCU0_MPORT_COMPONENT_INFO_ADDR A:0x6041c000
y.create.l HWIO_BIMC_M_TCU0_MPORT_CONFIGURATION_INFO_0_ADDR A:0x6041c020
y.create.l HWIO_BIMC_M_TCU0_MPORT_CONFIGURATION_INFO_1_ADDR A:0x6041c030
y.create.l HWIO_BIMC_M_TCU0_MPORT_CONFIGURATION_INFO_2A_ADDR A:0x6041c040
y.create.l HWIO_BIMC_M_TCU0_MPORT_CONFIGURATION_INFO_2B_ADDR A:0x6041c044
y.create.l HWIO_BIMC_M_TCU0_MPORT_CONFIGURATION_INFO_3_ADDR A:0x6041c050
y.create.l HWIO_BIMC_M_TCU0_MPORT_CONFIGURATION_INFO_4_ADDR A:0x6041c060
y.create.l HWIO_BIMC_M_TCU0_MPORT_CONFIGURATION_INFO_5A_ADDR A:0x6041c070
y.create.l HWIO_BIMC_M_TCU0_MPORT_CONFIGURATION_INFO_5B_ADDR A:0x6041c074
y.create.l HWIO_BIMC_M_TCU0_MPORT_CONFIGURATION_INFO_5C_ADDR A:0x6041c078
y.create.l HWIO_BIMC_M_TCU0_MPORT_CONFIGURATION_INFO_5D_ADDR A:0x6041c07c
y.create.l HWIO_BIMC_M_TCU0_MPORT_INTERRUPT_STATUS_ADDR A:0x6041c100
y.create.l HWIO_BIMC_M_TCU0_MPORT_INTERRUPT_CLEAR_ADDR A:0x6041c108
y.create.l HWIO_BIMC_M_TCU0_MPORT_INTERRUPT_ENABLE_ADDR A:0x6041c10c
y.create.l HWIO_BIMC_M_TCU0_MPORT_CLOCK_CTRL_ADDR A:0x6041c200
y.create.l HWIO_BIMC_M_TCU0_MPORT_CDC_CTRL_ADDR A:0x6041c208
y.create.l HWIO_BIMC_M_TCU0_MPORT_MODE_ADDR A:0x6041c210
y.create.l HWIO_BIMC_M_TCU0_MPORT_WR_WAY_CROSSING_ADDR A:0x6041c220
y.create.l HWIO_BIMC_M_TCU0_MPORT_PRIORITYLVL_OVERRIDE_ADDR A:0x6041c230
y.create.l HWIO_BIMC_M_TCU0_MPORT_READ_COMMAND_OVERRIDE_ADDR A:0x6041c240
y.create.l HWIO_BIMC_M_TCU0_MPORT_WRITE_COMMAND_OVERRIDE_ADDR A:0x6041c250
y.create.l HWIO_BIMC_M_TCU0_MPORT_RD_TRACKING_INDEX_ADDR A:0x6041c270
y.create.l HWIO_BIMC_M_TCU0_MPORT_WR_TRACKING_INDEX_ADDR A:0x6041c274
y.create.l HWIO_BIMC_M_TCU0_MPORT_BWMON_ENABLE_ADDR A:0x6041c280
y.create.l HWIO_BIMC_M_TCU0_MPORT_BWMON_CLEAR_ADDR A:0x6041c284
y.create.l HWIO_BIMC_M_TCU0_MPORT_BWMON_BYTE_COUNT_ADDR A:0x6041c288
y.create.l HWIO_BIMC_M_TCU0_MPORT_BWMON_THRESHOLD_ADDR A:0x6041c290
y.create.l HWIO_BIMC_M_TCU0_MPORT_BWMON_MID_MASK_ADDR A:0x6041c298
y.create.l HWIO_BIMC_M_TCU0_MPORT_BWMON_MID_MATCH_ADDR A:0x6041c29c
y.create.l HWIO_BIMC_M_TCU0_MPORT_BKE_ENABLE_ADDR A:0x6041c300
y.create.l HWIO_BIMC_M_TCU0_MPORT_BKE_GRANT_PERIOD_ADDR A:0x6041c304
y.create.l HWIO_BIMC_M_TCU0_MPORT_BKE_GRANT_COUNT_ADDR A:0x6041c308
y.create.l HWIO_BIMC_M_TCU0_MPORT_BKE_THRESHOLD_HIGH_ADDR A:0x6041c320
y.create.l HWIO_BIMC_M_TCU0_MPORT_BKE_THRESHOLD_MEDIUM_ADDR A:0x6041c324
y.create.l HWIO_BIMC_M_TCU0_MPORT_BKE_THRESHOLD_LOW_ADDR A:0x6041c328
y.create.l HWIO_BIMC_M_TCU0_MPORT_BKE_HEALTH_0_ADDR A:0x6041c340
y.create.l HWIO_BIMC_M_TCU0_MPORT_BKE_HEALTH_1_ADDR A:0x6041c344
y.create.l HWIO_BIMC_M_TCU0_MPORT_BKE_HEALTH_2_ADDR A:0x6041c348
y.create.l HWIO_BIMC_M_TCU0_MPORT_BKE_HEALTH_3_ADDR A:0x6041c34c
y.create.l HWIO_BIMC_M_TCU0_MPORT_STATUS_2A_ADDR A:0x6041c420
y.create.l HWIO_BIMC_M_TCU0_MPORT_STATUS_2B_ADDR A:0x6041c424
y.create.l HWIO_BIMC_M_TCU0_MPORT_STATUS_3A_ADDR A:0x6041c430
y.create.l HWIO_BIMC_M_TCU0_MPORT_STATUS_3B_ADDR A:0x6041c434
y.create.l HWIO_BIMC_M_TCU0_MPORT_BKE1_ENABLE_ADDR A:0x6041c800
y.create.l HWIO_BIMC_M_TCU0_MPORT_BKE1_GRANT_PERIOD_ADDR A:0x6041c804
y.create.l HWIO_BIMC_M_TCU0_MPORT_BKE1_GRANT_COUNT_ADDR A:0x6041c808
y.create.l HWIO_BIMC_M_TCU0_MPORT_BKE1_THRESHOLD_HIGH_ADDR A:0x6041c820
y.create.l HWIO_BIMC_M_TCU0_MPORT_BKE1_THRESHOLD_MEDIUM_ADDR A:0x6041c824
y.create.l HWIO_BIMC_M_TCU0_MPORT_BKE1_THRESHOLD_LOW_ADDR A:0x6041c828
y.create.l HWIO_BIMC_M_TCU0_MPORT_BKE1_HEALTH_0_ADDR A:0x6041c840
y.create.l HWIO_BIMC_M_TCU0_MPORT_BKE1_HEALTH_1_ADDR A:0x6041c844
y.create.l HWIO_BIMC_M_TCU0_MPORT_BKE1_HEALTH_2_ADDR A:0x6041c848
y.create.l HWIO_BIMC_M_TCU0_MPORT_BKE1_HEALTH_3_ADDR A:0x6041c84c
y.create.l HWIO_BIMC_M_TCU0_MPORT_BKE2_ENABLE_ADDR A:0x6041c900
y.create.l HWIO_BIMC_M_TCU0_MPORT_BKE2_GRANT_PERIOD_ADDR A:0x6041c904
y.create.l HWIO_BIMC_M_TCU0_MPORT_BKE2_GRANT_COUNT_ADDR A:0x6041c908
y.create.l HWIO_BIMC_M_TCU0_MPORT_BKE2_THRESHOLD_HIGH_ADDR A:0x6041c920
y.create.l HWIO_BIMC_M_TCU0_MPORT_BKE2_THRESHOLD_MEDIUM_ADDR A:0x6041c924
y.create.l HWIO_BIMC_M_TCU0_MPORT_BKE2_THRESHOLD_LOW_ADDR A:0x6041c928
y.create.l HWIO_BIMC_M_TCU0_MPORT_BKE2_HEALTH_0_ADDR A:0x6041c940
y.create.l HWIO_BIMC_M_TCU0_MPORT_BKE2_HEALTH_1_ADDR A:0x6041c944
y.create.l HWIO_BIMC_M_TCU0_MPORT_BKE2_HEALTH_2_ADDR A:0x6041c948
y.create.l HWIO_BIMC_M_TCU0_MPORT_BKE2_HEALTH_3_ADDR A:0x6041c94c
y.create.l HWIO_BIMC_M_TCU0_MPORT_BKE3_ENABLE_ADDR A:0x6041ca00
y.create.l HWIO_BIMC_M_TCU0_MPORT_BKE3_GRANT_PERIOD_ADDR A:0x6041ca04
y.create.l HWIO_BIMC_M_TCU0_MPORT_BKE3_GRANT_COUNT_ADDR A:0x6041ca08
y.create.l HWIO_BIMC_M_TCU0_MPORT_BKE3_THRESHOLD_HIGH_ADDR A:0x6041ca20
y.create.l HWIO_BIMC_M_TCU0_MPORT_BKE3_THRESHOLD_MEDIUM_ADDR A:0x6041ca24
y.create.l HWIO_BIMC_M_TCU0_MPORT_BKE3_THRESHOLD_LOW_ADDR A:0x6041ca28
y.create.l HWIO_BIMC_M_TCU0_MPORT_BKE3_HEALTH_0_ADDR A:0x6041ca40
y.create.l HWIO_BIMC_M_TCU0_MPORT_BKE3_HEALTH_1_ADDR A:0x6041ca44
y.create.l HWIO_BIMC_M_TCU0_MPORT_BKE3_HEALTH_2_ADDR A:0x6041ca48
y.create.l HWIO_BIMC_M_TCU0_MPORT_BKE3_HEALTH_3_ADDR A:0x6041ca4c
y.create.l HWIO_BIMC_M_TCU0_PROF_COMPONENT_INFO_ADDR A:0x6041d000
y.create.l HWIO_BIMC_M_TCU0_PROF_CONFIGURATION_INFO_0_ADDR A:0x6041d020
y.create.l HWIO_BIMC_M_TCU0_PROF_CONFIGURATION_INFO_1_ADDR A:0x6041d030
y.create.l HWIO_BIMC_M_TCU0_PROF_CLOCK_CTRL_ADDR A:0x6041d200
y.create.l HWIO_BIMC_M_TCU0_PROF_MODE_ADDR A:0x6041d210
y.create.l HWIO_BIMC_M_TCU0_PROF_RD_TENURE_THRESHOLD_ADDR A:0x6041d214
y.create.l HWIO_BIMC_M_TCU0_PROF_WR_TENURE_THRESHOLD_ADDR A:0x6041d218
y.create.l HWIO_BIMC_M_TCU0_PROF_SWAY_SELECT_ADDR A:0x6041d220
y.create.l HWIO_BIMC_M_TCU0_PROF_MID_MASK_ADDR A:0x6041d230
y.create.l HWIO_BIMC_M_TCU0_PROF_MID_MATCH_ADDR A:0x6041d234
y.create.l HWIO_BIMC_M_TCU0_PROF_MID_INV_MATCH_ADDR A:0x6041d238
y.create.l HWIO_BIMC_M_TCU0_PROF_ADDR_MASK_LOWER_ADDR A:0x6041d240
y.create.l HWIO_BIMC_M_TCU0_PROF_ADDR_MASK_UPPER_ADDR A:0x6041d244
y.create.l HWIO_BIMC_M_TCU0_PROF_ADDR_MATCH_LOWER_ADDR A:0x6041d248
y.create.l HWIO_BIMC_M_TCU0_PROF_ADDR_MATCH_UPPER_ADDR A:0x6041d24c
y.create.l HWIO_BIMC_M_TCU0_PROF_ADDR_INV_MATCH_ADDR A:0x6041d250
y.create.l HWIO_BIMC_M_TCU0_PROF_ACH_MASK_0_ADDR A:0x6041d260
y.create.l HWIO_BIMC_M_TCU0_PROF_ACH_MATCH_0_ADDR A:0x6041d264
y.create.l HWIO_BIMC_M_TCU0_PROF_ACH_MASK_1_ADDR A:0x6041d270
y.create.l HWIO_BIMC_M_TCU0_PROF_ACH_MATCH_1_ADDR A:0x6041d274
y.create.l HWIO_BIMC_M_TCU0_PROF_ACH_INV_MATCH_1_ADDR A:0x6041d278
y.create.l HWIO_BIMC_M_TCU0_PROF_ACH_MASK_2_ADDR A:0x6041d280
y.create.l HWIO_BIMC_M_TCU0_PROF_ACH_MATCH_2_ADDR A:0x6041d284
y.create.l HWIO_BIMC_M_TCU0_PROF_ACH_MASK_3_ADDR A:0x6041d290
y.create.l HWIO_BIMC_M_TCU0_PROF_ACH_MATCH_3_ADDR A:0x6041d294
y.create.l HWIO_BIMC_M_TCU0_PROF_ACH_INV_MATCH_3_ADDR A:0x6041d298
y.create.l HWIO_BIMC_M_TCU0_PROF_ACH_MASK_4_ADDR A:0x6041d2a0
y.create.l HWIO_BIMC_M_TCU0_PROF_ACH_MATCH_4_ADDR A:0x6041d2a4
y.create.l HWIO_BIMC_M_TCU0_PROF_ACH_INV_MATCH_4_ADDR A:0x6041d2a8
y.create.l HWIO_BIMC_M_TCU0_PROF_BCH_MASK_ADDR A:0x6041d300
y.create.l HWIO_BIMC_M_TCU0_PROF_BCH_MATCH_ADDR A:0x6041d304
y.create.l HWIO_BIMC_M_TCU0_PROF_BCH_INV_MATCH_ADDR A:0x6041d308
y.create.l HWIO_BIMC_M_TCU0_PROF_RCH_MASK_ADDR A:0x6041d340
y.create.l HWIO_BIMC_M_TCU0_PROF_RCH_MATCH_ADDR A:0x6041d344
y.create.l HWIO_BIMC_M_TCU0_PROF_RCH_INV_MATCH_ADDR A:0x6041d348
y.create.l HWIO_BIMC_M_TCU0_PROF_RD_STATUS_0_ADDR A:0x6041d400
y.create.l HWIO_BIMC_M_TCU0_PROF_WR_STATUS_0_ADDR A:0x6041d410
y.create.l HWIO_BIMC_M_TCU1_MPORT_COMPONENT_INFO_ADDR A:0x60420000
y.create.l HWIO_BIMC_M_TCU1_MPORT_CONFIGURATION_INFO_0_ADDR A:0x60420020
y.create.l HWIO_BIMC_M_TCU1_MPORT_CONFIGURATION_INFO_1_ADDR A:0x60420030
y.create.l HWIO_BIMC_M_TCU1_MPORT_CONFIGURATION_INFO_2A_ADDR A:0x60420040
y.create.l HWIO_BIMC_M_TCU1_MPORT_CONFIGURATION_INFO_2B_ADDR A:0x60420044
y.create.l HWIO_BIMC_M_TCU1_MPORT_CONFIGURATION_INFO_3_ADDR A:0x60420050
y.create.l HWIO_BIMC_M_TCU1_MPORT_CONFIGURATION_INFO_4_ADDR A:0x60420060
y.create.l HWIO_BIMC_M_TCU1_MPORT_CONFIGURATION_INFO_5A_ADDR A:0x60420070
y.create.l HWIO_BIMC_M_TCU1_MPORT_CONFIGURATION_INFO_5B_ADDR A:0x60420074
y.create.l HWIO_BIMC_M_TCU1_MPORT_CONFIGURATION_INFO_5C_ADDR A:0x60420078
y.create.l HWIO_BIMC_M_TCU1_MPORT_CONFIGURATION_INFO_5D_ADDR A:0x6042007c
y.create.l HWIO_BIMC_M_TCU1_MPORT_INTERRUPT_STATUS_ADDR A:0x60420100
y.create.l HWIO_BIMC_M_TCU1_MPORT_INTERRUPT_CLEAR_ADDR A:0x60420108
y.create.l HWIO_BIMC_M_TCU1_MPORT_INTERRUPT_ENABLE_ADDR A:0x6042010c
y.create.l HWIO_BIMC_M_TCU1_MPORT_CLOCK_CTRL_ADDR A:0x60420200
y.create.l HWIO_BIMC_M_TCU1_MPORT_CDC_CTRL_ADDR A:0x60420208
y.create.l HWIO_BIMC_M_TCU1_MPORT_MODE_ADDR A:0x60420210
y.create.l HWIO_BIMC_M_TCU1_MPORT_WR_WAY_CROSSING_ADDR A:0x60420220
y.create.l HWIO_BIMC_M_TCU1_MPORT_PRIORITYLVL_OVERRIDE_ADDR A:0x60420230
y.create.l HWIO_BIMC_M_TCU1_MPORT_READ_COMMAND_OVERRIDE_ADDR A:0x60420240
y.create.l HWIO_BIMC_M_TCU1_MPORT_WRITE_COMMAND_OVERRIDE_ADDR A:0x60420250
y.create.l HWIO_BIMC_M_TCU1_MPORT_RD_TRACKING_INDEX_ADDR A:0x60420270
y.create.l HWIO_BIMC_M_TCU1_MPORT_WR_TRACKING_INDEX_ADDR A:0x60420274
y.create.l HWIO_BIMC_M_TCU1_MPORT_BWMON_ENABLE_ADDR A:0x60420280
y.create.l HWIO_BIMC_M_TCU1_MPORT_BWMON_CLEAR_ADDR A:0x60420284
y.create.l HWIO_BIMC_M_TCU1_MPORT_BWMON_BYTE_COUNT_ADDR A:0x60420288
y.create.l HWIO_BIMC_M_TCU1_MPORT_BWMON_THRESHOLD_ADDR A:0x60420290
y.create.l HWIO_BIMC_M_TCU1_MPORT_BWMON_MID_MASK_ADDR A:0x60420298
y.create.l HWIO_BIMC_M_TCU1_MPORT_BWMON_MID_MATCH_ADDR A:0x6042029c
y.create.l HWIO_BIMC_M_TCU1_MPORT_BKE_ENABLE_ADDR A:0x60420300
y.create.l HWIO_BIMC_M_TCU1_MPORT_BKE_GRANT_PERIOD_ADDR A:0x60420304
y.create.l HWIO_BIMC_M_TCU1_MPORT_BKE_GRANT_COUNT_ADDR A:0x60420308
y.create.l HWIO_BIMC_M_TCU1_MPORT_BKE_THRESHOLD_HIGH_ADDR A:0x60420320
y.create.l HWIO_BIMC_M_TCU1_MPORT_BKE_THRESHOLD_MEDIUM_ADDR A:0x60420324
y.create.l HWIO_BIMC_M_TCU1_MPORT_BKE_THRESHOLD_LOW_ADDR A:0x60420328
y.create.l HWIO_BIMC_M_TCU1_MPORT_BKE_HEALTH_0_ADDR A:0x60420340
y.create.l HWIO_BIMC_M_TCU1_MPORT_BKE_HEALTH_1_ADDR A:0x60420344
y.create.l HWIO_BIMC_M_TCU1_MPORT_BKE_HEALTH_2_ADDR A:0x60420348
y.create.l HWIO_BIMC_M_TCU1_MPORT_BKE_HEALTH_3_ADDR A:0x6042034c
y.create.l HWIO_BIMC_M_TCU1_MPORT_STATUS_2A_ADDR A:0x60420420
y.create.l HWIO_BIMC_M_TCU1_MPORT_STATUS_2B_ADDR A:0x60420424
y.create.l HWIO_BIMC_M_TCU1_MPORT_STATUS_3A_ADDR A:0x60420430
y.create.l HWIO_BIMC_M_TCU1_MPORT_STATUS_3B_ADDR A:0x60420434
y.create.l HWIO_BIMC_M_TCU1_MPORT_BKE1_ENABLE_ADDR A:0x60420800
y.create.l HWIO_BIMC_M_TCU1_MPORT_BKE1_GRANT_PERIOD_ADDR A:0x60420804
y.create.l HWIO_BIMC_M_TCU1_MPORT_BKE1_GRANT_COUNT_ADDR A:0x60420808
y.create.l HWIO_BIMC_M_TCU1_MPORT_BKE1_THRESHOLD_HIGH_ADDR A:0x60420820
y.create.l HWIO_BIMC_M_TCU1_MPORT_BKE1_THRESHOLD_MEDIUM_ADDR A:0x60420824
y.create.l HWIO_BIMC_M_TCU1_MPORT_BKE1_THRESHOLD_LOW_ADDR A:0x60420828
y.create.l HWIO_BIMC_M_TCU1_MPORT_BKE1_HEALTH_0_ADDR A:0x60420840
y.create.l HWIO_BIMC_M_TCU1_MPORT_BKE1_HEALTH_1_ADDR A:0x60420844
y.create.l HWIO_BIMC_M_TCU1_MPORT_BKE1_HEALTH_2_ADDR A:0x60420848
y.create.l HWIO_BIMC_M_TCU1_MPORT_BKE1_HEALTH_3_ADDR A:0x6042084c
y.create.l HWIO_BIMC_M_TCU1_MPORT_BKE2_ENABLE_ADDR A:0x60420900
y.create.l HWIO_BIMC_M_TCU1_MPORT_BKE2_GRANT_PERIOD_ADDR A:0x60420904
y.create.l HWIO_BIMC_M_TCU1_MPORT_BKE2_GRANT_COUNT_ADDR A:0x60420908
y.create.l HWIO_BIMC_M_TCU1_MPORT_BKE2_THRESHOLD_HIGH_ADDR A:0x60420920
y.create.l HWIO_BIMC_M_TCU1_MPORT_BKE2_THRESHOLD_MEDIUM_ADDR A:0x60420924
y.create.l HWIO_BIMC_M_TCU1_MPORT_BKE2_THRESHOLD_LOW_ADDR A:0x60420928
y.create.l HWIO_BIMC_M_TCU1_MPORT_BKE2_HEALTH_0_ADDR A:0x60420940
y.create.l HWIO_BIMC_M_TCU1_MPORT_BKE2_HEALTH_1_ADDR A:0x60420944
y.create.l HWIO_BIMC_M_TCU1_MPORT_BKE2_HEALTH_2_ADDR A:0x60420948
y.create.l HWIO_BIMC_M_TCU1_MPORT_BKE2_HEALTH_3_ADDR A:0x6042094c
y.create.l HWIO_BIMC_M_TCU1_MPORT_BKE3_ENABLE_ADDR A:0x60420a00
y.create.l HWIO_BIMC_M_TCU1_MPORT_BKE3_GRANT_PERIOD_ADDR A:0x60420a04
y.create.l HWIO_BIMC_M_TCU1_MPORT_BKE3_GRANT_COUNT_ADDR A:0x60420a08
y.create.l HWIO_BIMC_M_TCU1_MPORT_BKE3_THRESHOLD_HIGH_ADDR A:0x60420a20
y.create.l HWIO_BIMC_M_TCU1_MPORT_BKE3_THRESHOLD_MEDIUM_ADDR A:0x60420a24
y.create.l HWIO_BIMC_M_TCU1_MPORT_BKE3_THRESHOLD_LOW_ADDR A:0x60420a28
y.create.l HWIO_BIMC_M_TCU1_MPORT_BKE3_HEALTH_0_ADDR A:0x60420a40
y.create.l HWIO_BIMC_M_TCU1_MPORT_BKE3_HEALTH_1_ADDR A:0x60420a44
y.create.l HWIO_BIMC_M_TCU1_MPORT_BKE3_HEALTH_2_ADDR A:0x60420a48
y.create.l HWIO_BIMC_M_TCU1_MPORT_BKE3_HEALTH_3_ADDR A:0x60420a4c
y.create.l HWIO_BIMC_M_TCU1_PROF_COMPONENT_INFO_ADDR A:0x60421000
y.create.l HWIO_BIMC_M_TCU1_PROF_CONFIGURATION_INFO_0_ADDR A:0x60421020
y.create.l HWIO_BIMC_M_TCU1_PROF_CONFIGURATION_INFO_1_ADDR A:0x60421030
y.create.l HWIO_BIMC_M_TCU1_PROF_CLOCK_CTRL_ADDR A:0x60421200
y.create.l HWIO_BIMC_M_TCU1_PROF_MODE_ADDR A:0x60421210
y.create.l HWIO_BIMC_M_TCU1_PROF_RD_TENURE_THRESHOLD_ADDR A:0x60421214
y.create.l HWIO_BIMC_M_TCU1_PROF_WR_TENURE_THRESHOLD_ADDR A:0x60421218
y.create.l HWIO_BIMC_M_TCU1_PROF_SWAY_SELECT_ADDR A:0x60421220
y.create.l HWIO_BIMC_M_TCU1_PROF_MID_MASK_ADDR A:0x60421230
y.create.l HWIO_BIMC_M_TCU1_PROF_MID_MATCH_ADDR A:0x60421234
y.create.l HWIO_BIMC_M_TCU1_PROF_MID_INV_MATCH_ADDR A:0x60421238
y.create.l HWIO_BIMC_M_TCU1_PROF_ADDR_MASK_LOWER_ADDR A:0x60421240
y.create.l HWIO_BIMC_M_TCU1_PROF_ADDR_MASK_UPPER_ADDR A:0x60421244
y.create.l HWIO_BIMC_M_TCU1_PROF_ADDR_MATCH_LOWER_ADDR A:0x60421248
y.create.l HWIO_BIMC_M_TCU1_PROF_ADDR_MATCH_UPPER_ADDR A:0x6042124c
y.create.l HWIO_BIMC_M_TCU1_PROF_ADDR_INV_MATCH_ADDR A:0x60421250
y.create.l HWIO_BIMC_M_TCU1_PROF_ACH_MASK_0_ADDR A:0x60421260
y.create.l HWIO_BIMC_M_TCU1_PROF_ACH_MATCH_0_ADDR A:0x60421264
y.create.l HWIO_BIMC_M_TCU1_PROF_ACH_MASK_1_ADDR A:0x60421270
y.create.l HWIO_BIMC_M_TCU1_PROF_ACH_MATCH_1_ADDR A:0x60421274
y.create.l HWIO_BIMC_M_TCU1_PROF_ACH_INV_MATCH_1_ADDR A:0x60421278
y.create.l HWIO_BIMC_M_TCU1_PROF_ACH_MASK_2_ADDR A:0x60421280
y.create.l HWIO_BIMC_M_TCU1_PROF_ACH_MATCH_2_ADDR A:0x60421284
y.create.l HWIO_BIMC_M_TCU1_PROF_ACH_MASK_3_ADDR A:0x60421290
y.create.l HWIO_BIMC_M_TCU1_PROF_ACH_MATCH_3_ADDR A:0x60421294
y.create.l HWIO_BIMC_M_TCU1_PROF_ACH_INV_MATCH_3_ADDR A:0x60421298
y.create.l HWIO_BIMC_M_TCU1_PROF_ACH_MASK_4_ADDR A:0x604212a0
y.create.l HWIO_BIMC_M_TCU1_PROF_ACH_MATCH_4_ADDR A:0x604212a4
y.create.l HWIO_BIMC_M_TCU1_PROF_ACH_INV_MATCH_4_ADDR A:0x604212a8
y.create.l HWIO_BIMC_M_TCU1_PROF_BCH_MASK_ADDR A:0x60421300
y.create.l HWIO_BIMC_M_TCU1_PROF_BCH_MATCH_ADDR A:0x60421304
y.create.l HWIO_BIMC_M_TCU1_PROF_BCH_INV_MATCH_ADDR A:0x60421308
y.create.l HWIO_BIMC_M_TCU1_PROF_RCH_MASK_ADDR A:0x60421340
y.create.l HWIO_BIMC_M_TCU1_PROF_RCH_MATCH_ADDR A:0x60421344
y.create.l HWIO_BIMC_M_TCU1_PROF_RCH_INV_MATCH_ADDR A:0x60421348
y.create.l HWIO_BIMC_M_TCU1_PROF_RD_STATUS_0_ADDR A:0x60421400
y.create.l HWIO_BIMC_M_TCU1_PROF_WR_STATUS_0_ADDR A:0x60421410
y.create.l HWIO_BIMC_S_SYS_SWAY_COMPONENT_INFO_ADDR A:0x60450000
y.create.l HWIO_BIMC_S_SYS_SWAY_CONFIGURATION_INFO_0_ADDR A:0x60450020
y.create.l HWIO_BIMC_S_SYS_SWAY_CONFIGURATION_INFO_1_ADDR A:0x60450030
y.create.l HWIO_BIMC_S_SYS_SWAY_CONFIGURATION_INFO_2_ADDR A:0x60450040
y.create.l HWIO_BIMC_S_SYS_SWAY_CONFIGURATION_INFO_3_ADDR A:0x60450050
y.create.l HWIO_BIMC_S_SYS_SWAY_CONFIGURATION_INFO_4_ADDR A:0x60450060
y.create.l HWIO_BIMC_S_SYS_SWAY_CONFIGURATION_INFO_5_ADDR A:0x60450070
y.create.l HWIO_BIMC_S_SYS_SWAY_CONFIGURATION_INFO_6A_ADDR A:0x60450080
y.create.l HWIO_BIMC_S_SYS_SWAY_CONFIGURATION_INFO_6B_ADDR A:0x60450084
y.create.l HWIO_BIMC_S_SYS_SWAY_CONFIGURATION_INFO_6C_ADDR A:0x60450088
y.create.l HWIO_BIMC_S_SYS_SWAY_CONFIGURATION_INFO_6D_ADDR A:0x6045008c
y.create.l HWIO_BIMC_S_SYS_SWAY_INTERRUPT_STATUS_ADDR A:0x60450100
y.create.l HWIO_BIMC_S_SYS_SWAY_INTERRUPT_CLEAR_ADDR A:0x60450108
y.create.l HWIO_BIMC_S_SYS_SWAY_INTERRUPT_ENABLE_ADDR A:0x6045010c
y.create.l HWIO_BIMC_S_SYS_SWAY_CLOCK_CTRL_ADDR A:0x60450200
y.create.l HWIO_BIMC_S_SYS_SWAY_CDC_CTRL_ADDR A:0x60450208
y.create.l HWIO_BIMC_S_SYS_SWAY_RCH_SELECT_ADDR A:0x60450210
y.create.l HWIO_BIMC_S_SYS_SWAY_MAX_OUTSTANDING_REQUESTS_ADDR A:0x60450220
y.create.l HWIO_BIMC_S_SYS_SWAY_GATHERING_ADDR A:0x60450230
y.create.l HWIO_BIMC_S_SYS_SWAY_MODE_ADDR A:0x60450240
y.create.l HWIO_BIMC_S_SYS_SWAY_READ_COMMAND_OVERRIDE_ADDR A:0x60450250
y.create.l HWIO_BIMC_S_SYS_SWAY_WRITE_COMMAND_OVERRIDE_ADDR A:0x60450260
y.create.l HWIO_BIMC_S_SYS_SWAY_STATUS_0A_ADDR A:0x60450400
y.create.l HWIO_BIMC_S_SYS_SWAY_STATUS_0B_ADDR A:0x60450404
y.create.l HWIO_BIMC_S_SYS_SWAY_STATUS_0C_ADDR A:0x60450408
y.create.l HWIO_BIMC_S_SYS_SWAY_STATUS_0D_ADDR A:0x6045040c
y.create.l HWIO_BIMC_S_SYS_SWAY_STATUS_1A_ADDR A:0x60450410
y.create.l HWIO_BIMC_S_SYS_SWAY_STATUS_1B_ADDR A:0x60450414
y.create.l HWIO_BIMC_S_SYS_SWAY_STATUS_1C_ADDR A:0x60450418
y.create.l HWIO_BIMC_S_DEFAULT_SWAY_COMPONENT_INFO_ADDR A:0x60458000
y.create.l HWIO_BIMC_S_DEFAULT_SWAY_CONFIGURATION_INFO_0_ADDR A:0x60458020
y.create.l HWIO_BIMC_S_DEFAULT_SWAY_CONFIGURATION_INFO_1_ADDR A:0x60458030
y.create.l HWIO_BIMC_S_DEFAULT_SWAY_INTERRUPT_STATUS_ADDR A:0x60458100
y.create.l HWIO_BIMC_S_DEFAULT_SWAY_INTERRUPT_CLEAR_ADDR A:0x60458108
y.create.l HWIO_BIMC_S_DEFAULT_SWAY_INTERRUPT_ENABLE_ADDR A:0x6045810c
y.create.l HWIO_BIMC_S_DEFAULT_SWAY_DEFAULT_SLAVE_STATUS_0_ADDR A:0x60458400
y.create.l HWIO_BIMC_S_DEFAULT_SWAY_DEFAULT_SLAVE_STATUS_1_ADDR A:0x60458410
y.create.l HWIO_BIMC_S_DEFAULT_SWAY_DEFAULT_SLAVE_STATUS_2_ADDR A:0x60458420
y.create.l HWIO_BIMC_S_DDR0_ARB_COMPONENT_INFO_ADDR A:0x60449000
y.create.l HWIO_BIMC_S_DDR0_ARB_CONFIGURATION_INFO_0_ADDR A:0x60449020
y.create.l HWIO_BIMC_S_DDR0_ARB_CONFIGURATION_INFO_1_ADDR A:0x60449030
y.create.l HWIO_BIMC_S_DDR0_ARB_CLOCK_CTRL_ADDR A:0x60449200
y.create.l HWIO_BIMC_S_DDR0_ARB_MODE_ADDR A:0x60449210
y.create.l HWIO_BIMC_S_DDR0_ARB_MASTER0_GRANTS_ADDR A:0x60449220
y.create.l HWIO_BIMC_S_DDR0_ARB_MASTER1_GRANTS_ADDR A:0x60449224
y.create.l HWIO_BIMC_S_DDR0_ARB_MASTER2_GRANTS_ADDR A:0x60449228
y.create.l HWIO_BIMC_S_DDR0_ARB_MASTER3_GRANTS_ADDR A:0x6044922c
y.create.l HWIO_BIMC_S_DDR0_ARB_MASTER4_GRANTS_ADDR A:0x60449230
y.create.l HWIO_BIMC_S_DDR0_ARB_MASTER5_GRANTS_ADDR A:0x60449234
y.create.l HWIO_BIMC_S_DDR0_ARB_MASTER6_GRANTS_ADDR A:0x60449238
y.create.l HWIO_BIMC_S_SYS_ARB_COMPONENT_INFO_ADDR A:0x60451000
y.create.l HWIO_BIMC_S_SYS_ARB_CONFIGURATION_INFO_0_ADDR A:0x60451020
y.create.l HWIO_BIMC_S_SYS_ARB_CONFIGURATION_INFO_1_ADDR A:0x60451030
y.create.l HWIO_BIMC_S_SYS_ARB_CLOCK_CTRL_ADDR A:0x60451200
y.create.l HWIO_BIMC_S_SYS_ARB_MODE_ADDR A:0x60451210
y.create.l HWIO_BIMC_S_DEFAULT_ARB_COMPONENT_INFO_ADDR A:0x60459000
y.create.l HWIO_BIMC_S_DEFAULT_ARB_CONFIGURATION_INFO_0_ADDR A:0x60459020
y.create.l HWIO_BIMC_S_DEFAULT_ARB_CONFIGURATION_INFO_1_ADDR A:0x60459030
y.create.l HWIO_BIMC_S_DEFAULT_ARB_CLOCK_CTRL_ADDR A:0x60459200
y.create.l HWIO_BIMC_S_DEFAULT_ARB_MODE_ADDR A:0x60459210
y.create.l HWIO_BIMC_S_DDR0_SCMO_COMPONENT_INFO_ADDR A:0x60448000
y.create.l HWIO_BIMC_S_DDR0_SCMO_HW_INFO_ADDR A:0x60448010
y.create.l HWIO_BIMC_S_DDR0_SCMO_CONFIGURATION_INFO_0_ADDR A:0x60448020
y.create.l HWIO_BIMC_S_DDR0_SCMO_CONFIGURATION_INFO_1_ADDR A:0x60448030
y.create.l HWIO_BIMC_S_DDR0_SCMO_CONFIGURATION_INFO_2_ADDR A:0x60448040
y.create.l HWIO_BIMC_S_DDR0_SCMO_CONFIGURATION_INFO_3_ADDR A:0x60448050
y.create.l HWIO_BIMC_S_DDR0_SCMO_CONFIGURATION_INFO_4_ADDR A:0x60448060
y.create.l HWIO_BIMC_S_DDR0_SCMO_CONFIGURATION_INFO_5_ADDR A:0x60448070
y.create.l HWIO_BIMC_S_DDR0_SCMO_CONFIGURATION_INFO_6_ADDR A:0x60448080
y.create.l HWIO_BIMC_S_DDR0_SCMO_INTERRUPT_STATUS_ADDR A:0x60448100
y.create.l HWIO_BIMC_S_DDR0_SCMO_INTERRUPT_CLEAR_ADDR A:0x60448108
y.create.l HWIO_BIMC_S_DDR0_SCMO_INTERRUPT_ENABLE_ADDR A:0x6044810c
y.create.l HWIO_BIMC_S_DDR0_SCMO_ESYN_ADDR_ADDR A:0x60448120
y.create.l HWIO_BIMC_S_DDR0_SCMO_ESYN_APACKET_0_ADDR A:0x60448128
y.create.l HWIO_BIMC_S_DDR0_SCMO_ESYN_APACKET_1_ADDR A:0x6044812c
y.create.l HWIO_BIMC_S_DDR0_SCMO_ESYN_APACKET_2_ADDR A:0x60448130
y.create.l HWIO_BIMC_S_DDR0_SCMO_CLOCK_CTRL_ADDR A:0x60448200
y.create.l HWIO_BIMC_S_DDR0_SCMO_SLV_INTERLEAVE_CFG_ADDR A:0x60448400
y.create.l HWIO_BIMC_S_DDR0_SCMO_ADDR_BASE_CS0_ADDR A:0x60448410
y.create.l HWIO_BIMC_S_DDR0_SCMO_ADDR_BASE_CS1_ADDR A:0x60448414
y.create.l HWIO_BIMC_S_DDR0_SCMO_ADDR_MAP_CS0_ADDR A:0x60448420
y.create.l HWIO_BIMC_S_DDR0_SCMO_ADDR_MAP_CS1_ADDR A:0x60448424
y.create.l HWIO_BIMC_S_DDR0_SCMO_ADDR_MASK_CS0_ADDR A:0x60448430
y.create.l HWIO_BIMC_S_DDR0_SCMO_ADDR_MASK_CS1_ADDR A:0x60448434
y.create.l HWIO_BIMC_S_DDR0_SCMO_SLV_STATUS_ADDR A:0x60448450
y.create.l HWIO_BIMC_S_DDR0_SCMO_GLOBAL_MON_CFG_ADDR A:0x60448460
y.create.l HWIO_BIMC_S_DDR0_SCMO_CMD_BUF_CFG_ADDR A:0x60448500
y.create.l HWIO_BIMC_S_DDR0_SCMO_CMD_BUF_STATUS_ADDR A:0x60448520
y.create.l HWIO_BIMC_S_DDR0_SCMO_RCH_SELECT_ADDR A:0x60448540
y.create.l HWIO_BIMC_S_DDR0_SCMO_RCH_BKPR_CFG_ADDR A:0x60448544
y.create.l HWIO_BIMC_S_DDR0_SCMO_RCH_STATUS_ADDR A:0x60448560
y.create.l HWIO_BIMC_S_DDR0_SCMO_WCH_BUF_CFG_ADDR A:0x60448580
y.create.l HWIO_BIMC_S_DDR0_SCMO_WCH_STATUS_ADDR A:0x604485a0
y.create.l HWIO_BIMC_S_DDR0_SCMO_FLUSH_CFG_ADDR A:0x604485c0
y.create.l HWIO_BIMC_S_DDR0_SCMO_FLUSH_CMD_ADDR A:0x604485c4
y.create.l HWIO_BIMC_S_DDR0_SCMO_CMD_OPT_CFG0_ADDR A:0x60448700
y.create.l HWIO_BIMC_S_DDR0_SCMO_CMD_OPT_CFG1_ADDR A:0x60448704
y.create.l HWIO_BIMC_S_DDR0_SCMO_CMD_OPT_CFG2_ADDR A:0x60448708
y.create.l HWIO_BIMC_S_DDR0_SCMO_CMD_OPT_CFG3_ADDR A:0x6044870c
y.create.l HWIO_BIMC_S_DDR0_SCMO_CMD_OPT_CFG4_ADDR A:0x60448710
y.create.l HWIO_BIMC_S_DDR0_SCMO_FSP_STATUS_ADDR A:0x60448a40
y.create.l HWIO_BIMC_S_DDR0_XPU_SCR_ADDR A:0x6044a000
y.create.l HWIO_BIMC_S_DDR0_XPU_SWDR_ADDR A:0x6044a004
y.create.l HWIO_BIMC_S_DDR0_XPU_PRTN_RACR_SSHADOW_ADDR A:0x6044a008
y.create.l HWIO_BIMC_S_DDR0_XPU_PRTN_WACR_SSHADOW_ADDR A:0x6044a00c
y.create.l HWIO_BIMC_S_DDR0_XPU_PRTN_START_SSHADOW0_ADDR A:0x6044a010
y.create.l HWIO_BIMC_S_DDR0_XPU_PRTN_END_SSHADOW0_ADDR A:0x6044a018
y.create.l HWIO_BIMC_S_DDR0_XPU_SEAR0_ADDR A:0x6044a040
y.create.l HWIO_BIMC_S_DDR0_XPU_SESR_ADDR A:0x6044a048
y.create.l HWIO_BIMC_S_DDR0_XPU_SESRRESTORE_ADDR A:0x6044a04c
y.create.l HWIO_BIMC_S_DDR0_XPU_SESYNR0_ADDR A:0x6044a050
y.create.l HWIO_BIMC_S_DDR0_XPU_SESYNR1_ADDR A:0x6044a054
y.create.l HWIO_BIMC_S_DDR0_XPU_SESYNR2_ADDR A:0x6044a058
y.create.l HWIO_BIMC_S_DDR0_XPU_MCR_ADDR A:0x6044a100
y.create.l HWIO_BIMC_S_DDR0_XPU_MEAR0_ADDR A:0x6044a140
y.create.l HWIO_BIMC_S_DDR0_XPU_MESR_ADDR A:0x6044a148
y.create.l HWIO_BIMC_S_DDR0_XPU_MESRRESTORE_ADDR A:0x6044a14c
y.create.l HWIO_BIMC_S_DDR0_XPU_MESYNR0_ADDR A:0x6044a150
y.create.l HWIO_BIMC_S_DDR0_XPU_MESYNR1_ADDR A:0x6044a154
y.create.l HWIO_BIMC_S_DDR0_XPU_MESYNR2_ADDR A:0x6044a158
y.create.l HWIO_BIMC_S_DDR0_XPU_CR_ADDR A:0x6044a080
y.create.l HWIO_BIMC_S_DDR0_XPU_PRTN_RACR_SHADOW_ADDR A:0x6044a088
y.create.l HWIO_BIMC_S_DDR0_XPU_PRTN_WACR_SHADOW_ADDR A:0x6044a08c
y.create.l HWIO_BIMC_S_DDR0_XPU_PRTN_START_SHADOW0_ADDR A:0x6044a090
y.create.l HWIO_BIMC_S_DDR0_XPU_PRTN_END_SHADOW0_ADDR A:0x6044a098
y.create.l HWIO_BIMC_S_DDR0_XPU_RPU_ACR0_ADDR A:0x6044a0a0
y.create.l HWIO_BIMC_S_DDR0_XPU_EAR0_ADDR A:0x6044a0c0
y.create.l HWIO_BIMC_S_DDR0_XPU_ESR_ADDR A:0x6044a0c8
y.create.l HWIO_BIMC_S_DDR0_XPU_ESRRESTORE_ADDR A:0x6044a0cc
y.create.l HWIO_BIMC_S_DDR0_XPU_ESYNR0_ADDR A:0x6044a0d0
y.create.l HWIO_BIMC_S_DDR0_XPU_ESYNR1_ADDR A:0x6044a0d4
y.create.l HWIO_BIMC_S_DDR0_XPU_ESYNR2_ADDR A:0x6044a0d8
y.create.l HWIO_BIMC_S_DDR0_XPU_UMR_RACR_ADDR A:0x6044a0e0
y.create.l HWIO_BIMC_S_DDR0_XPU_UMR_WACR_ADDR A:0x6044a0e4
y.create.l HWIO_BIMC_S_DDR0_XPU_UMR_CNTL_ADDR A:0x6044a0f0
y.create.l HWIO_BIMC_S_DDR0_XPU_IDR0_ADDR A:0x6044a074
y.create.l HWIO_BIMC_S_DDR0_XPU_IDR1_ADDR A:0x6044a078
y.create.l HWIO_BIMC_S_DDR0_XPU_REV_ADDR A:0x6044a07c
y.create.l HWIO_BIMC_S_DDR0_XPU_PRT0_RACR0_ADDR A:0x6044a200
y.create.l HWIO_BIMC_S_DDR0_XPU_PRT1_RACR0_ADDR A:0x6044a280
y.create.l HWIO_BIMC_S_DDR0_XPU_PRT2_RACR0_ADDR A:0x6044a300
y.create.l HWIO_BIMC_S_DDR0_XPU_PRT3_RACR0_ADDR A:0x6044a380
y.create.l HWIO_BIMC_S_DDR0_XPU_PRT4_RACR0_ADDR A:0x6044a400
y.create.l HWIO_BIMC_S_DDR0_XPU_PRT5_RACR0_ADDR A:0x6044a480
y.create.l HWIO_BIMC_S_DDR0_XPU_PRT6_RACR0_ADDR A:0x6044a500
y.create.l HWIO_BIMC_S_DDR0_XPU_PRT7_RACR0_ADDR A:0x6044a580
y.create.l HWIO_BIMC_S_DDR0_XPU_PRT8_RACR0_ADDR A:0x6044a600
y.create.l HWIO_BIMC_S_DDR0_XPU_PRT9_RACR0_ADDR A:0x6044a680
y.create.l HWIO_BIMC_S_DDR0_XPU_PRT0_WACR0_ADDR A:0x6044a220
y.create.l HWIO_BIMC_S_DDR0_XPU_PRT1_WACR0_ADDR A:0x6044a2a0
y.create.l HWIO_BIMC_S_DDR0_XPU_PRT2_WACR0_ADDR A:0x6044a320
y.create.l HWIO_BIMC_S_DDR0_XPU_PRT3_WACR0_ADDR A:0x6044a3a0
y.create.l HWIO_BIMC_S_DDR0_XPU_PRT4_WACR0_ADDR A:0x6044a420
y.create.l HWIO_BIMC_S_DDR0_XPU_PRT5_WACR0_ADDR A:0x6044a4a0
y.create.l HWIO_BIMC_S_DDR0_XPU_PRT6_WACR0_ADDR A:0x6044a520
y.create.l HWIO_BIMC_S_DDR0_XPU_PRT7_WACR0_ADDR A:0x6044a5a0
y.create.l HWIO_BIMC_S_DDR0_XPU_PRT8_WACR0_ADDR A:0x6044a620
y.create.l HWIO_BIMC_S_DDR0_XPU_PRT9_WACR0_ADDR A:0x6044a6a0
y.create.l HWIO_BIMC_S_DDR0_XPU_PRT0_START0_ADDR A:0x6044a240
y.create.l HWIO_BIMC_S_DDR0_XPU_PRT1_START0_ADDR A:0x6044a2c0
y.create.l HWIO_BIMC_S_DDR0_XPU_PRT2_START0_ADDR A:0x6044a340
y.create.l HWIO_BIMC_S_DDR0_XPU_PRT3_START0_ADDR A:0x6044a3c0
y.create.l HWIO_BIMC_S_DDR0_XPU_PRT4_START0_ADDR A:0x6044a440
y.create.l HWIO_BIMC_S_DDR0_XPU_PRT5_START0_ADDR A:0x6044a4c0
y.create.l HWIO_BIMC_S_DDR0_XPU_PRT6_START0_ADDR A:0x6044a540
y.create.l HWIO_BIMC_S_DDR0_XPU_PRT7_START0_ADDR A:0x6044a5c0
y.create.l HWIO_BIMC_S_DDR0_XPU_PRT8_START0_ADDR A:0x6044a640
y.create.l HWIO_BIMC_S_DDR0_XPU_PRT9_START0_ADDR A:0x6044a6c0
y.create.l HWIO_BIMC_S_DDR0_XPU_PRT0_END0_ADDR A:0x6044a248
y.create.l HWIO_BIMC_S_DDR0_XPU_PRT1_END0_ADDR A:0x6044a2c8
y.create.l HWIO_BIMC_S_DDR0_XPU_PRT2_END0_ADDR A:0x6044a348
y.create.l HWIO_BIMC_S_DDR0_XPU_PRT3_END0_ADDR A:0x6044a3c8
y.create.l HWIO_BIMC_S_DDR0_XPU_PRT4_END0_ADDR A:0x6044a448
y.create.l HWIO_BIMC_S_DDR0_XPU_PRT5_END0_ADDR A:0x6044a4c8
y.create.l HWIO_BIMC_S_DDR0_XPU_PRT6_END0_ADDR A:0x6044a548
y.create.l HWIO_BIMC_S_DDR0_XPU_PRT7_END0_ADDR A:0x6044a5c8
y.create.l HWIO_BIMC_S_DDR0_XPU_PRT8_END0_ADDR A:0x6044a648
y.create.l HWIO_BIMC_S_DDR0_XPU_PRT9_END0_ADDR A:0x6044a6c8
y.create.l HWIO_BIMC_S_DDR0_XPU_PRT0_SCR_ADDR A:0x6044a250
y.create.l HWIO_BIMC_S_DDR0_XPU_PRT1_SCR_ADDR A:0x6044a2d0
y.create.l HWIO_BIMC_S_DDR0_XPU_PRT2_SCR_ADDR A:0x6044a350
y.create.l HWIO_BIMC_S_DDR0_XPU_PRT3_SCR_ADDR A:0x6044a3d0
y.create.l HWIO_BIMC_S_DDR0_XPU_PRT4_SCR_ADDR A:0x6044a450
y.create.l HWIO_BIMC_S_DDR0_XPU_PRT5_SCR_ADDR A:0x6044a4d0
y.create.l HWIO_BIMC_S_DDR0_XPU_PRT6_SCR_ADDR A:0x6044a550
y.create.l HWIO_BIMC_S_DDR0_XPU_PRT7_SCR_ADDR A:0x6044a5d0
y.create.l HWIO_BIMC_S_DDR0_XPU_PRT8_SCR_ADDR A:0x6044a650
y.create.l HWIO_BIMC_S_DDR0_XPU_PRT9_SCR_ADDR A:0x6044a6d0
y.create.l HWIO_BIMC_S_DDR0_XPU_PRT0_MCR_ADDR A:0x6044a254
y.create.l HWIO_BIMC_S_DDR0_XPU_PRT1_MCR_ADDR A:0x6044a2d4
y.create.l HWIO_BIMC_S_DDR0_XPU_PRT2_MCR_ADDR A:0x6044a354
y.create.l HWIO_BIMC_S_DDR0_XPU_PRT3_MCR_ADDR A:0x6044a3d4
y.create.l HWIO_BIMC_S_DDR0_XPU_PRT4_MCR_ADDR A:0x6044a454
y.create.l HWIO_BIMC_S_DDR0_XPU_PRT5_MCR_ADDR A:0x6044a4d4
y.create.l HWIO_BIMC_S_DDR0_XPU_PRT6_MCR_ADDR A:0x6044a554
y.create.l HWIO_BIMC_S_DDR0_XPU_PRT7_MCR_ADDR A:0x6044a5d4
y.create.l HWIO_BIMC_S_DDR0_XPU_PRT8_MCR_ADDR A:0x6044a654
y.create.l HWIO_BIMC_S_DDR0_XPU_PRT9_MCR_ADDR A:0x6044a6d4
y.create.l HWIO_BIMC_S_DDR0_XPU_PRT0_CNTL0_ADDR A:0x6044a258
y.create.l HWIO_BIMC_S_DDR0_XPU_PRT1_CNTL0_ADDR A:0x6044a2d8
y.create.l HWIO_BIMC_S_DDR0_XPU_PRT2_CNTL0_ADDR A:0x6044a358
y.create.l HWIO_BIMC_S_DDR0_XPU_PRT3_CNTL0_ADDR A:0x6044a3d8
y.create.l HWIO_BIMC_S_DDR0_XPU_PRT4_CNTL0_ADDR A:0x6044a458
y.create.l HWIO_BIMC_S_DDR0_XPU_PRT5_CNTL0_ADDR A:0x6044a4d8
y.create.l HWIO_BIMC_S_DDR0_XPU_PRT6_CNTL0_ADDR A:0x6044a558
y.create.l HWIO_BIMC_S_DDR0_XPU_PRT7_CNTL0_ADDR A:0x6044a5d8
y.create.l HWIO_BIMC_S_DDR0_XPU_PRT8_CNTL0_ADDR A:0x6044a658
y.create.l HWIO_BIMC_S_DDR0_XPU_PRT9_CNTL0_ADDR A:0x6044a6d8
y.create.l HWIO_BIMC_S_DDR0_XPU_PRT0_CNTL1_ADDR A:0x6044a25c
y.create.l HWIO_BIMC_S_DDR0_XPU_PRT1_CNTL1_ADDR A:0x6044a2dc
y.create.l HWIO_BIMC_S_DDR0_XPU_PRT2_CNTL1_ADDR A:0x6044a35c
y.create.l HWIO_BIMC_S_DDR0_XPU_PRT3_CNTL1_ADDR A:0x6044a3dc
y.create.l HWIO_BIMC_S_DDR0_XPU_PRT4_CNTL1_ADDR A:0x6044a45c
y.create.l HWIO_BIMC_S_DDR0_XPU_PRT5_CNTL1_ADDR A:0x6044a4dc
y.create.l HWIO_BIMC_S_DDR0_XPU_PRT6_CNTL1_ADDR A:0x6044a55c
y.create.l HWIO_BIMC_S_DDR0_XPU_PRT7_CNTL1_ADDR A:0x6044a5dc
y.create.l HWIO_BIMC_S_DDR0_XPU_PRT8_CNTL1_ADDR A:0x6044a65c
y.create.l HWIO_BIMC_S_DDR0_XPU_PRT9_CNTL1_ADDR A:0x6044a6dc
y.create.l HWIO_BIMC_S_DDR0_XPU_AMT_RACR_ADDR A:0x6044a0e8
y.create.l HWIO_BIMC_S_DDR0_XPU_AMT_WACR_ADDR A:0x6044a0ec
y.create.l HWIO_BIMC_S_DDR0_XPU_AMTR0_ADDR A:0x6044ae80
y.create.l HWIO_BIMC_S_DDR0_XPU_AMTR1_ADDR A:0x6044ae84
y.create.l HWIO_BIMC_S_DDR0_XPU_AMTR2_ADDR A:0x6044ae88
y.create.l HWIO_BIMC_S_DDR0_XPU_AMTR3_ADDR A:0x6044ae8c
y.create.l HWIO_BIMC_S_DDR0_XPU_AMTR4_ADDR A:0x6044ae90
y.create.l HWIO_BIMC_S_DDR0_XPU_AMTR5_ADDR A:0x6044ae94
y.create.l HWIO_BIMC_S_DDR0_XPU_AMTR6_ADDR A:0x6044ae98
y.create.l HWIO_BIMC_S_DDR0_XPU_AMTR7_ADDR A:0x6044ae9c
y.create.l HWIO_BIMC_S_DDR0_XPU_AMTR8_ADDR A:0x6044aea0
y.create.l HWIO_BIMC_S_DDR0_XPU_AMTR9_ADDR A:0x6044aea4
y.create.l HWIO_BIMC_S_DDR0_DPE_HW_INFO_ADDR A:0x6044c000
y.create.l HWIO_BIMC_S_DDR0_DPE_CONFIG_0_ADDR A:0x6044c010
y.create.l HWIO_BIMC_S_DDR0_DPE_CONFIG_1_ADDR A:0x6044c014
y.create.l HWIO_BIMC_S_DDR0_DPE_CONFIG_2_ADDR A:0x6044c018
y.create.l HWIO_BIMC_S_DDR0_DPE_CONFIG_3_ADDR A:0x6044c01c
y.create.l HWIO_BIMC_S_DDR0_DPE_CONFIG_4_ADDR A:0x6044c020
y.create.l HWIO_BIMC_S_DDR0_DPE_CONFIG_5_ADDR A:0x6044c024
y.create.l HWIO_BIMC_S_DDR0_DPE_CONFIG_6_ADDR A:0x6044c028
y.create.l HWIO_BIMC_S_DDR0_DPE_CONFIG_7_ADDR A:0x6044c02c
y.create.l HWIO_BIMC_S_DDR0_DPE_CONFIG_DQ_MAP_ADDR A:0x6044c038
y.create.l HWIO_BIMC_S_DDR0_DPE_ODT_CONFIG_0_ADDR A:0x6044c040
y.create.l HWIO_BIMC_S_DDR0_DPE_ODT_CONFIG_1_ADDR A:0x6044c044
y.create.l HWIO_BIMC_S_DDR0_DPE_CA_TRAIN_PRE_CS_ADDR A:0x6044c050
y.create.l HWIO_BIMC_S_DDR0_DPE_CA_TRAIN_CS_ADDR A:0x6044c054
y.create.l HWIO_BIMC_S_DDR0_DPE_CA_TRAIN_POST_CS_ADDR A:0x6044c058
y.create.l HWIO_BIMC_S_DDR0_DPE_RCW_CTRL_ADDR A:0x6044c060
y.create.l HWIO_BIMC_S_DDR0_DPE_PWR_CTRL_0_ADDR A:0x6044c068
y.create.l HWIO_BIMC_S_DDR0_DPE_OPT_CTRL_0_ADDR A:0x6044c078
y.create.l HWIO_BIMC_S_DDR0_DPE_OPT_CTRL_1_ADDR A:0x6044c07c
y.create.l HWIO_BIMC_S_DDR0_DPE_DRAM_STATUS_0_ADDR A:0x6044c08c
y.create.l HWIO_BIMC_S_DDR0_DPE_MEMC_STATUS_0_ADDR A:0x6044c09c
y.create.l HWIO_BIMC_S_DDR0_DPE_MEMC_STATUS_1_ADDR A:0x6044c0a0
y.create.l HWIO_BIMC_S_DDR0_DPE_MEMC_STATUS_2_ADDR A:0x6044c0a4
y.create.l HWIO_BIMC_S_DDR0_DPE_INTERRUPT_ENABLE_ADDR A:0x6044c0b4
y.create.l HWIO_BIMC_S_DDR0_DPE_INTERRUPT_STATUS_ADDR A:0x6044c0b8
y.create.l HWIO_BIMC_S_DDR0_DPE_INTERRUPT_CLR_ADDR A:0x6044c0bc
y.create.l HWIO_BIMC_S_DDR0_DPE_INTERRUPT_SET_ADDR A:0x6044c0c0
y.create.l HWIO_BIMC_S_DDR0_DPE_ELEVATE_PRI_RD_ADDR A:0x6044c0d0
y.create.l HWIO_BIMC_S_DDR0_DPE_ELEVATE_PRI_WR_ADDR A:0x6044c0d4
y.create.l HWIO_BIMC_S_DDR0_DPE_TIMER_0_ADDR A:0x6044c0e4
y.create.l HWIO_BIMC_S_DDR0_DPE_TIMER_1_ADDR A:0x6044c0e8
y.create.l HWIO_BIMC_S_DDR0_DPE_TIMER_2_ADDR A:0x6044c0ec
y.create.l HWIO_BIMC_S_DDR0_DPE_TIMER_3_ADDR A:0x6044c0f0
y.create.l HWIO_BIMC_S_DDR0_DPE_MRW_BEFORE_FREQ_SWITCH_0_ADDR A:0x6044c114
y.create.l HWIO_BIMC_S_DDR0_DPE_MRW_BEFORE_FREQ_SWITCH_1_ADDR A:0x6044c118
y.create.l HWIO_BIMC_S_DDR0_DPE_MRW_BEFORE_FREQ_SWITCH_2_ADDR A:0x6044c11c
y.create.l HWIO_BIMC_S_DDR0_DPE_MRW_BEFORE_FREQ_SWITCH_3_ADDR A:0x6044c120
y.create.l HWIO_BIMC_S_DDR0_DPE_MRW_AFTER_FREQ_SWITCH_0_ADDR A:0x6044c124
y.create.l HWIO_BIMC_S_DDR0_DPE_MRW_AFTER_FREQ_SWITCH_1_ADDR A:0x6044c128
y.create.l HWIO_BIMC_S_DDR0_DPE_MRW_AFTER_FREQ_SWITCH_2_ADDR A:0x6044c12c
y.create.l HWIO_BIMC_S_DDR0_DPE_MRW_AFTER_FREQ_SWITCH_3_ADDR A:0x6044c130
y.create.l HWIO_BIMC_S_DDR0_DPE_MRW_FREQ_SWITCH_ADDR A:0x6044c134
y.create.l HWIO_BIMC_S_DDR0_DPE_DRAM_TIMING_0_ADDR A:0x6044c144
y.create.l HWIO_BIMC_S_DDR0_DPE_DRAM_TIMING_1_ADDR A:0x6044c148
y.create.l HWIO_BIMC_S_DDR0_DPE_DRAM_TIMING_2_ADDR A:0x6044c14c
y.create.l HWIO_BIMC_S_DDR0_DPE_DRAM_TIMING_3_ADDR A:0x6044c150
y.create.l HWIO_BIMC_S_DDR0_DPE_DRAM_TIMING_4_ADDR A:0x6044c154
y.create.l HWIO_BIMC_S_DDR0_DPE_DRAM_TIMING_5_ADDR A:0x6044c158
y.create.l HWIO_BIMC_S_DDR0_DPE_DRAM_TIMING_6_ADDR A:0x6044c15c
y.create.l HWIO_BIMC_S_DDR0_DPE_DRAM_TIMING_7_ADDR A:0x6044c160
y.create.l HWIO_BIMC_S_DDR0_DPE_DRAM_TIMING_8_ADDR A:0x6044c164
y.create.l HWIO_BIMC_S_DDR0_DPE_DRAM_TIMING_9_ADDR A:0x6044c168
y.create.l HWIO_BIMC_S_DDR0_DPE_DRAM_TIMING_10_ADDR A:0x6044c16c
y.create.l HWIO_BIMC_S_DDR0_DPE_DRAM_TIMING_11_ADDR A:0x6044c170
y.create.l HWIO_BIMC_S_DDR0_DPE_DRAM_TIMING_12_ADDR A:0x6044c174
y.create.l HWIO_BIMC_S_DDR0_DPE_DRAM_TIMING_13_ADDR A:0x6044c178
y.create.l HWIO_BIMC_S_DDR0_DPE_DRAM_TIMING_14_ADDR A:0x6044c17c
y.create.l HWIO_BIMC_S_DDR0_DPE_DRAM_TIMING_15_ADDR A:0x6044c180
y.create.l HWIO_BIMC_S_DDR0_DPE_DRAM_TIMING_16_ADDR A:0x6044c184
y.create.l HWIO_BIMC_S_DDR0_DPE_DRAM_TIMING_17_ADDR A:0x6044c188
y.create.l HWIO_BIMC_S_DDR0_DPE_DRAM_TIMING_18_ADDR A:0x6044c18c
y.create.l HWIO_BIMC_S_DDR0_DPE_DRAM_TIMING_19_ADDR A:0x6044c190
y.create.l HWIO_BIMC_S_DDR0_DPE_DRAM_TIMING_20_ADDR A:0x6044c194
y.create.l HWIO_BIMC_S_DDR0_DPE_DRAM_TIMING_21_ADDR A:0x6044c198
y.create.l HWIO_BIMC_S_DDR0_DPE_DRAM_TIMING_22_ADDR A:0x6044c19c
y.create.l HWIO_BIMC_S_DDR0_DPE_DRAM_TIMING_23_ADDR A:0x6044c1a0
y.create.l HWIO_BIMC_S_DDR0_DPE_DRAM_TIMING_0_ACT_ADDR A:0x6044c1a4
y.create.l HWIO_BIMC_S_DDR0_DPE_DRAM_TIMING_1_ACT_ADDR A:0x6044c1a8
y.create.l HWIO_BIMC_S_DDR0_DPE_DRAM_TIMING_2_ACT_ADDR A:0x6044c1ac
y.create.l HWIO_BIMC_S_DDR0_DPE_DRAM_TIMING_3_ACT_ADDR A:0x6044c1b0
y.create.l HWIO_BIMC_S_DDR0_DPE_DRAM_TIMING_4_ACT_ADDR A:0x6044c1b4
y.create.l HWIO_BIMC_S_DDR0_DPE_DRAM_TIMING_5_ACT_ADDR A:0x6044c1b8
y.create.l HWIO_BIMC_S_DDR0_DPE_DRAM_TIMING_6_ACT_ADDR A:0x6044c1bc
y.create.l HWIO_BIMC_S_DDR0_DPE_DRAM_TIMING_7_ACT_ADDR A:0x6044c1c0
y.create.l HWIO_BIMC_S_DDR0_DPE_DRAM_TIMING_8_ACT_ADDR A:0x6044c1c4
y.create.l HWIO_BIMC_S_DDR0_DPE_DRAM_TIMING_9_ACT_ADDR A:0x6044c1c8
y.create.l HWIO_BIMC_S_DDR0_DPE_DRAM_TIMING_10_ACT_ADDR A:0x6044c1cc
y.create.l HWIO_BIMC_S_DDR0_DPE_DRAM_TIMING_11_ACT_ADDR A:0x6044c1d0
y.create.l HWIO_BIMC_S_DDR0_DPE_DRAM_TIMING_12_ACT_ADDR A:0x6044c1d4
y.create.l HWIO_BIMC_S_DDR0_DPE_DRAM_TIMING_13_ACT_ADDR A:0x6044c1d8
y.create.l HWIO_BIMC_S_DDR0_DPE_DRAM_TIMING_14_ACT_ADDR A:0x6044c1dc
y.create.l HWIO_BIMC_S_DDR0_DPE_DRAM_TIMING_15_ACT_ADDR A:0x6044c1e0
y.create.l HWIO_BIMC_S_DDR0_DPE_DRAM_TIMING_16_ACT_ADDR A:0x6044c1e4
y.create.l HWIO_BIMC_S_DDR0_DPE_DRAM_TIMING_17_ACT_ADDR A:0x6044c1e8
y.create.l HWIO_BIMC_S_DDR0_DPE_DRAM_TIMING_18_ACT_ADDR A:0x6044c1ec
y.create.l HWIO_BIMC_S_DDR0_DPE_DRAM_TIMING_19_ACT_ADDR A:0x6044c1f0
y.create.l HWIO_BIMC_S_DDR0_DPE_DRAM_TIMING_20_ACT_ADDR A:0x6044c1f4
y.create.l HWIO_BIMC_S_DDR0_DPE_DRAM_TIMING_21_ACT_ADDR A:0x6044c1f8
y.create.l HWIO_BIMC_S_DDR0_DPE_DRAM_TIMING_22_ACT_ADDR A:0x6044c1fc
y.create.l HWIO_BIMC_S_DDR0_DPE_DRAM_TIMING_23_ACT_ADDR A:0x6044c200
y.create.l HWIO_BIMC_S_DDR0_DPE_TESTBUS_CTRL_ADDR A:0x6044c204
y.create.l HWIO_BIMC_S_DDR0_DPE_SPARE_REG_ADDR A:0x6044c214
y.create.l HWIO_BIMC_S_DDR0_DPE_SPARE_REG_ACT_ADDR A:0x6044c224
y.create.l HWIO_BIMC_S_DDR0_DPE_DQCAL_RDATA_RANK1_U_ADDR A:0x6044c240
y.create.l HWIO_BIMC_S_DDR0_DPE_DQCAL_RDATA_RANK1_L_ADDR A:0x6044c244
y.create.l HWIO_BIMC_S_DDR0_DPE_DQCAL_RDATA_RANK0_U_ADDR A:0x6044c248
y.create.l HWIO_BIMC_S_DDR0_DPE_DQCAL_RDATA_RANK0_L_ADDR A:0x6044c24c
y.create.l HWIO_BIMC_S_DDR0_DPE_DQCAL_STATUS0_RANK1_ADDR A:0x6044c260
y.create.l HWIO_BIMC_S_DDR0_DPE_DQCAL_STATUS1_RANK1_ADDR A:0x6044c264
y.create.l HWIO_BIMC_S_DDR0_DPE_DQCAL_STATUS2_RANK1_ADDR A:0x6044c268
y.create.l HWIO_BIMC_S_DDR0_DPE_DQCAL_STATUS0_RANK0_ADDR A:0x6044c280
y.create.l HWIO_BIMC_S_DDR0_DPE_DQCAL_STATUS1_RANK0_ADDR A:0x6044c284
y.create.l HWIO_BIMC_S_DDR0_DPE_DQCAL_STATUS2_RANK0_ADDR A:0x6044c288
y.create.l HWIO_BIMC_S_DDR0_DPE_CGC_CTRL_ADDR A:0x6044c2fc
y.create.l HWIO_BIMC_S_DDR0_DPE_PMON_EN_ADDR A:0x6044c300
y.create.l HWIO_BIMC_S_DDR0_DPE_PMON_CFG_ADDR A:0x6044c304
y.create.l HWIO_BIMC_S_DDR0_DPE_PMON_CMD_QUEUED_0_ADDR A:0x6044c310
y.create.l HWIO_BIMC_S_DDR0_DPE_PMON_CMD_QUEUED_1_ADDR A:0x6044c314
y.create.l HWIO_BIMC_S_DDR0_DPE_PMON_CMD_QUEUED_2_ADDR A:0x6044c318
y.create.l HWIO_BIMC_S_DDR0_DPE_PMON_CMD_QUEUED_3_ADDR A:0x6044c31c
y.create.l HWIO_BIMC_S_DDR0_DPE_PMON_CMD_EXEC_0_ADDR A:0x6044c320
y.create.l HWIO_BIMC_S_DDR0_DPE_PMON_CMD_EXEC_1_ADDR A:0x6044c324
y.create.l HWIO_BIMC_S_DDR0_DPE_PMON_CMD_EXEC_2_ADDR A:0x6044c328
y.create.l HWIO_BIMC_S_DDR0_DPE_PMON_CMD_EXEC_3_ADDR A:0x6044c32c
y.create.l HWIO_BIMC_S_DDR0_DPE_PMON_CMD_FLTR_0_ADDR A:0x6044c330
y.create.l HWIO_BIMC_S_DDR0_DPE_PMON_CMD_FLTR_1_ADDR A:0x6044c334
y.create.l HWIO_BIMC_S_DDR0_DPE_PMON_CMD_FLTR_2_ADDR A:0x6044c338
y.create.l HWIO_BIMC_S_DDR0_DPE_PMON_CMD_FLTR_3_ADDR A:0x6044c33c
y.create.l HWIO_BIMC_S_DDR0_DPE_PMON_ADDR_FLTR_0_ADDR A:0x6044c340
y.create.l HWIO_BIMC_S_DDR0_DPE_PMON_ADDR_FLTR_1_ADDR A:0x6044c344
y.create.l HWIO_BIMC_S_DDR0_DPE_PMON_ADDR_FLTR_2_ADDR A:0x6044c348
y.create.l HWIO_BIMC_S_DDR0_DPE_PMON_ADDR_FLTR_3_ADDR A:0x6044c34c
y.create.l HWIO_BIMC_S_DDR0_DPE_PMON_MID_FLTR_0_ADDR A:0x6044c350
y.create.l HWIO_BIMC_S_DDR0_DPE_PMON_MID_FLTR_1_ADDR A:0x6044c354
y.create.l HWIO_BIMC_S_DDR0_DPE_PMON_LAT_LIM_0_ADDR A:0x6044c360
y.create.l HWIO_BIMC_S_DDR0_DPE_PMON_LAT_LIM_1_ADDR A:0x6044c364
y.create.l HWIO_BIMC_S_DDR0_DPE_PMON_LAT_LIM_2_ADDR A:0x6044c368
y.create.l HWIO_BIMC_S_DDR0_DPE_PMON_LAT_LIM_3_ADDR A:0x6044c36c
y.create.l HWIO_BIMC_S_DDR0_DPE_PMON_PRI_FLTR_0_ADDR A:0x6044c370
y.create.l HWIO_BIMC_S_DDR0_DPE_PMON_PRI_FLTR_1_ADDR A:0x6044c374
y.create.l HWIO_BIMC_S_DDR0_DPE_PMON_PRI_FLTR_2_ADDR A:0x6044c378
y.create.l HWIO_BIMC_S_DDR0_DPE_PMON_PRI_FLTR_3_ADDR A:0x6044c37c
y.create.l HWIO_BIMC_S_DDR0_DPE_PMON_CMDQ_0_ADDR A:0x6044c380
y.create.l HWIO_BIMC_S_DDR0_DPE_PMON_CMDQ_1_ADDR A:0x6044c384
y.create.l HWIO_BIMC_S_DDR0_DPE_PMON_WRBUF_0_ADDR A:0x6044c388
y.create.l HWIO_BIMC_S_DDR0_DPE_PMON_WRBUF_1_ADDR A:0x6044c38c
y.create.l HWIO_BIMC_S_DDR0_DPE_PMON_DDR_CMD_0_ADDR A:0x6044c390
y.create.l HWIO_BIMC_S_DDR0_DPE_PMON_DDR_CMD_1_ADDR A:0x6044c394
y.create.l HWIO_BIMC_S_DDR0_DPE_PMON_DDR_CMD_2_ADDR A:0x6044c398
y.create.l HWIO_BIMC_S_DDR0_DPE_PMON_DDR_CMD_3_ADDR A:0x6044c39c
y.create.l HWIO_BIMC_S_DDR0_DPE_PMON_DDR_DATA_0_ADDR A:0x6044c3a0
y.create.l HWIO_BIMC_S_DDR0_DPE_PMON_DDR_DATA_1_ADDR A:0x6044c3a4
y.create.l HWIO_BIMC_S_DDR0_DPE_PMON_RANK_STATE_0_ADDR A:0x6044c3b0
y.create.l HWIO_BIMC_S_DDR0_DPE_PMON_RANK_STATE_1_ADDR A:0x6044c3b4
y.create.l HWIO_BIMC_S_DDR0_DPE_PMON_RANK_STATE_2_ADDR A:0x6044c3b8
y.create.l HWIO_BIMC_S_DDR0_DPE_PMON_RANK_STATE_3_ADDR A:0x6044c3bc
y.create.l HWIO_BIMC_S_DDR0_DPE_PMON_SHKE_0_ADDR A:0x6044c3c0
y.create.l HWIO_BIMC_S_DDR0_DPE_PMON_SHKE_1_ADDR A:0x6044c3c4
y.create.l HWIO_BIMC_S_DDR0_DPE_PMON_SHKE_2_ADDR A:0x6044c3c8
y.create.l HWIO_BIMC_S_DDR0_DPE_PMON_SHKE_3_ADDR A:0x6044c3cc
y.create.l HWIO_BIMC_S_DDR0_DPE_PMON_SHKE_4_ADDR A:0x6044c3d0
y.create.l HWIO_BIMC_S_DDR0_DPE_PMON_SHKE_5_ADDR A:0x6044c3d4
y.create.l HWIO_BIMC_S_DDR0_DPE_PMON_SHKE_6_ADDR A:0x6044c3d8
y.create.l HWIO_BIMC_S_DDR0_DPE_PMON_SHKE_7_ADDR A:0x6044c3dc
y.create.l HWIO_BIMC_S_DDR0_SHKE_HW_INFO_ADDR A:0x6044d000
y.create.l HWIO_BIMC_S_DDR0_SHKE_CONFIG_ADDR A:0x6044d004
y.create.l HWIO_BIMC_S_DDR0_SHKE_CGC_CNTL_ADDR A:0x6044d010
y.create.l HWIO_BIMC_S_DDR0_SHKE_DRAM_MANUAL_0_ADDR A:0x6044d020
y.create.l HWIO_BIMC_S_DDR0_SHKE_DRAM_MANUAL_1_ADDR A:0x6044d024
y.create.l HWIO_BIMC_S_DDR0_SHKE_MREG_ADDR_WDATA_CNTL_ADDR A:0x6044d030
y.create.l HWIO_BIMC_S_DDR0_SHKE_MREG_RDATA_RANK1_U_ADDR A:0x6044d050
y.create.l HWIO_BIMC_S_DDR0_SHKE_MREG_RDATA_RANK1_L_ADDR A:0x6044d054
y.create.l HWIO_BIMC_S_DDR0_SHKE_MREG_RDATA_RANK0_U_ADDR A:0x6044d060
y.create.l HWIO_BIMC_S_DDR0_SHKE_MREG_RDATA_RANK0_L_ADDR A:0x6044d064
y.create.l HWIO_BIMC_S_DDR0_SHKE_MREG_RDATA_STATUS_ADDR A:0x6044d070
y.create.l HWIO_BIMC_S_DDR0_SHKE_DRAM_STATUS_ADDR A:0x6044d074
y.create.l HWIO_BIMC_S_DDR0_SHKE_DRAM_DEBUG_CMD_0_ADDR A:0x6044d080
y.create.l HWIO_BIMC_S_DDR0_SHKE_DRAM_DEBUG_CMD_1_ADDR A:0x6044d084
y.create.l HWIO_BIMC_S_DDR0_SHKE_DRAM_DEBUG_CMD_2_ADDR A:0x6044d088
y.create.l HWIO_BIMC_S_DDR0_SHKE_PERIODIC_MRR_ADDR A:0x6044d0a0
y.create.l HWIO_BIMC_S_DDR0_SHKE_PERIODIC_MRR_RDATA_RANK1_U_ADDR A:0x6044d0b0
y.create.l HWIO_BIMC_S_DDR0_SHKE_PERIODIC_MRR_RDATA_RANK1_L_ADDR A:0x6044d0b4
y.create.l HWIO_BIMC_S_DDR0_SHKE_PERIODIC_MRR_RDATA_RANK0_U_ADDR A:0x6044d0b8
y.create.l HWIO_BIMC_S_DDR0_SHKE_PERIODIC_MRR_RDATA_RANK0_L_ADDR A:0x6044d0bc
y.create.l HWIO_BIMC_S_DDR0_SHKE_PERIODIC_ZQCAL_ADDR A:0x6044d0d0
y.create.l HWIO_BIMC_S_DDR0_SHKE_AUTO_REFRESH_CNTL_ADDR A:0x6044d0f0
y.create.l HWIO_BIMC_S_DDR0_SHKE_SELF_REFRESH_CNTL_ADDR A:0x6044d0f4
y.create.l HWIO_BIMC_S_DDR0_SHKE_AUTO_REFRESH_CNTL_1_ADDR A:0x6044d100
y.create.l HWIO_BIMC_S_DDR0_SHKE_AUTO_REFRESH_CNTL_2_ADDR A:0x6044d104
y.create.l HWIO_BIMC_S_DDR0_SHKE_TESTBUS_CNTL_ADDR A:0x6044d114
y.create.l HWIO_BIMC_S_DDR0_SHKE_SPARE_REG_ADDR A:0x6044d130
y.create.l HWIO_BLSP1_BLSP_BAM_BAM_CTRL_ADDR A:0x67884000
y.create.l HWIO_BLSP1_BLSP_BAM_BAM_TIMER_ADDR A:0x67884040
y.create.l HWIO_BLSP1_BLSP_BAM_BAM_TIMER_CTRL_ADDR A:0x67884044
y.create.l HWIO_BLSP1_BLSP_BAM_BAM_DESC_CNT_TRSHLD_ADDR A:0x67884008
y.create.l HWIO_BLSP1_BLSP_BAM_BAM_IRQ_STTS_ADDR A:0x67884014
y.create.l HWIO_BLSP1_BLSP_BAM_BAM_IRQ_CLR_ADDR A:0x67884018
y.create.l HWIO_BLSP1_BLSP_BAM_BAM_IRQ_EN_ADDR A:0x6788401c
y.create.l HWIO_BLSP1_BLSP_BAM_BAM_CNFG_BITS_ADDR A:0x6788407c
y.create.l HWIO_BLSP1_BLSP_BAM_BAM_REVISION_ADDR A:0x67885000
y.create.l HWIO_BLSP1_BLSP_BAM_BAM_SW_VERSION_ADDR A:0x67885004
y.create.l HWIO_BLSP1_BLSP_BAM_BAM_NUM_PIPES_ADDR A:0x67885008
y.create.l HWIO_BLSP1_BLSP_BAM_BAM_TEST_BUS_SEL_ADDR A:0x67885010
y.create.l HWIO_BLSP1_BLSP_BAM_BAM_TEST_BUS_REG_ADDR A:0x67885014
y.create.l HWIO_BLSP1_BLSP_BAM_BAM_AHB_MASTER_ERR_CTRLS_ADDR A:0x67885024
y.create.l HWIO_BLSP1_BLSP_BAM_BAM_AHB_MASTER_ERR_ADDR_ADDR A:0x67885028
y.create.l HWIO_BLSP1_BLSP_BAM_BAM_AHB_MASTER_ERR_DATA_ADDR A:0x6788502c
y.create.l HWIO_BLSP1_BLSP_BAM_BAM_AHB_MASTER_ERR_ADDR_LSB_ADDR A:0x67885100
y.create.l HWIO_BLSP1_BLSP_BAM_BAM_AHB_MASTER_ERR_ADDR_MSB_ADDR A:0x67885104
y.create.l HWIO_BLSP1_BLSP_BAM_BAM_TRUST_REG_ADDR A:0x67886000
y.create.l HWIO_BLSP1_BLSP_BAM_BAM_P_TRUST_REG0_ADDR A:0x67886020
y.create.l HWIO_BLSP1_BLSP_BAM_BAM_P_TRUST_REG1_ADDR A:0x67886024
y.create.l HWIO_BLSP1_BLSP_BAM_BAM_P_TRUST_REG2_ADDR A:0x67886028
y.create.l HWIO_BLSP1_BLSP_BAM_BAM_P_TRUST_REG3_ADDR A:0x6788602c
y.create.l HWIO_BLSP1_BLSP_BAM_BAM_P_TRUST_REG4_ADDR A:0x67886030
y.create.l HWIO_BLSP1_BLSP_BAM_BAM_P_TRUST_REG5_ADDR A:0x67886034
y.create.l HWIO_BLSP1_BLSP_BAM_BAM_P_TRUST_REG6_ADDR A:0x67886038
y.create.l HWIO_BLSP1_BLSP_BAM_BAM_P_TRUST_REG7_ADDR A:0x6788603c
y.create.l HWIO_BLSP1_BLSP_BAM_BAM_P_TRUST_REG8_ADDR A:0x67886040
y.create.l HWIO_BLSP1_BLSP_BAM_BAM_P_TRUST_REG9_ADDR A:0x67886044
y.create.l HWIO_BLSP1_BLSP_BAM_BAM_IRQ_SRCS_EE0_ADDR A:0x67887000
y.create.l HWIO_BLSP1_BLSP_BAM_BAM_IRQ_SRCS_EE1_ADDR A:0x67888000
y.create.l HWIO_BLSP1_BLSP_BAM_BAM_IRQ_SRCS_EE2_ADDR A:0x67889000
y.create.l HWIO_BLSP1_BLSP_BAM_BAM_IRQ_SRCS_EE3_ADDR A:0x6788a000
y.create.l HWIO_BLSP1_BLSP_BAM_BAM_IRQ_SRCS_EE4_ADDR A:0x6788b000
y.create.l HWIO_BLSP1_BLSP_BAM_BAM_IRQ_SRCS_EE5_ADDR A:0x6788c000
y.create.l HWIO_BLSP1_BLSP_BAM_BAM_IRQ_SRCS_EE6_ADDR A:0x6788d000
y.create.l HWIO_BLSP1_BLSP_BAM_BAM_IRQ_SRCS_EE7_ADDR A:0x6788e000
y.create.l HWIO_BLSP1_BLSP_BAM_BAM_IRQ_SRCS_MSK_EE0_ADDR A:0x67887004
y.create.l HWIO_BLSP1_BLSP_BAM_BAM_IRQ_SRCS_MSK_EE1_ADDR A:0x67888004
y.create.l HWIO_BLSP1_BLSP_BAM_BAM_IRQ_SRCS_MSK_EE2_ADDR A:0x67889004
y.create.l HWIO_BLSP1_BLSP_BAM_BAM_IRQ_SRCS_MSK_EE3_ADDR A:0x6788a004
y.create.l HWIO_BLSP1_BLSP_BAM_BAM_IRQ_SRCS_MSK_EE4_ADDR A:0x6788b004
y.create.l HWIO_BLSP1_BLSP_BAM_BAM_IRQ_SRCS_MSK_EE5_ADDR A:0x6788c004
y.create.l HWIO_BLSP1_BLSP_BAM_BAM_IRQ_SRCS_MSK_EE6_ADDR A:0x6788d004
y.create.l HWIO_BLSP1_BLSP_BAM_BAM_IRQ_SRCS_MSK_EE7_ADDR A:0x6788e004
y.create.l HWIO_BLSP1_BLSP_BAM_BAM_IRQ_SRCS_UNMASKED_EE0_ADDR A:0x67887008
y.create.l HWIO_BLSP1_BLSP_BAM_BAM_IRQ_SRCS_UNMASKED_EE1_ADDR A:0x67888008
y.create.l HWIO_BLSP1_BLSP_BAM_BAM_IRQ_SRCS_UNMASKED_EE2_ADDR A:0x67889008
y.create.l HWIO_BLSP1_BLSP_BAM_BAM_IRQ_SRCS_UNMASKED_EE3_ADDR A:0x6788a008
y.create.l HWIO_BLSP1_BLSP_BAM_BAM_IRQ_SRCS_UNMASKED_EE4_ADDR A:0x6788b008
y.create.l HWIO_BLSP1_BLSP_BAM_BAM_IRQ_SRCS_UNMASKED_EE5_ADDR A:0x6788c008
y.create.l HWIO_BLSP1_BLSP_BAM_BAM_IRQ_SRCS_UNMASKED_EE6_ADDR A:0x6788d008
y.create.l HWIO_BLSP1_BLSP_BAM_BAM_IRQ_SRCS_UNMASKED_EE7_ADDR A:0x6788e008
y.create.l HWIO_BLSP1_BLSP_BAM_BAM_PIPE_ATTR_EE0_ADDR A:0x6788700c
y.create.l HWIO_BLSP1_BLSP_BAM_BAM_PIPE_ATTR_EE1_ADDR A:0x6788800c
y.create.l HWIO_BLSP1_BLSP_BAM_BAM_PIPE_ATTR_EE2_ADDR A:0x6788900c
y.create.l HWIO_BLSP1_BLSP_BAM_BAM_PIPE_ATTR_EE3_ADDR A:0x6788a00c
y.create.l HWIO_BLSP1_BLSP_BAM_BAM_PIPE_ATTR_EE4_ADDR A:0x6788b00c
y.create.l HWIO_BLSP1_BLSP_BAM_BAM_PIPE_ATTR_EE5_ADDR A:0x6788c00c
y.create.l HWIO_BLSP1_BLSP_BAM_BAM_PIPE_ATTR_EE6_ADDR A:0x6788d00c
y.create.l HWIO_BLSP1_BLSP_BAM_BAM_PIPE_ATTR_EE7_ADDR A:0x6788e00c
y.create.l HWIO_BLSP1_BLSP_BAM_BAM_IRQ_SRCS_ADDR A:0x67887010
y.create.l HWIO_BLSP1_BLSP_BAM_BAM_IRQ_SRCS_MSK_ADDR A:0x67887014
y.create.l HWIO_BLSP1_BLSP_BAM_BAM_IRQ_SRCS_UNMASKED_ADDR A:0x67887018
y.create.l HWIO_BLSP1_BLSP_BAM_BAM_P_CTRL0_ADDR A:0x67897000
y.create.l HWIO_BLSP1_BLSP_BAM_BAM_P_CTRL1_ADDR A:0x67898000
y.create.l HWIO_BLSP1_BLSP_BAM_BAM_P_CTRL2_ADDR A:0x67899000
y.create.l HWIO_BLSP1_BLSP_BAM_BAM_P_CTRL3_ADDR A:0x6789a000
y.create.l HWIO_BLSP1_BLSP_BAM_BAM_P_CTRL4_ADDR A:0x6789b000
y.create.l HWIO_BLSP1_BLSP_BAM_BAM_P_CTRL5_ADDR A:0x6789c000
y.create.l HWIO_BLSP1_BLSP_BAM_BAM_P_CTRL6_ADDR A:0x6789d000
y.create.l HWIO_BLSP1_BLSP_BAM_BAM_P_CTRL7_ADDR A:0x6789e000
y.create.l HWIO_BLSP1_BLSP_BAM_BAM_P_CTRL8_ADDR A:0x6789f000
y.create.l HWIO_BLSP1_BLSP_BAM_BAM_P_CTRL9_ADDR A:0x678a0000
y.create.l HWIO_BLSP1_BLSP_BAM_BAM_P_RST0_ADDR A:0x67897004
y.create.l HWIO_BLSP1_BLSP_BAM_BAM_P_RST1_ADDR A:0x67898004
y.create.l HWIO_BLSP1_BLSP_BAM_BAM_P_RST2_ADDR A:0x67899004
y.create.l HWIO_BLSP1_BLSP_BAM_BAM_P_RST3_ADDR A:0x6789a004
y.create.l HWIO_BLSP1_BLSP_BAM_BAM_P_RST4_ADDR A:0x6789b004
y.create.l HWIO_BLSP1_BLSP_BAM_BAM_P_RST5_ADDR A:0x6789c004
y.create.l HWIO_BLSP1_BLSP_BAM_BAM_P_RST6_ADDR A:0x6789d004
y.create.l HWIO_BLSP1_BLSP_BAM_BAM_P_RST7_ADDR A:0x6789e004
y.create.l HWIO_BLSP1_BLSP_BAM_BAM_P_RST8_ADDR A:0x6789f004
y.create.l HWIO_BLSP1_BLSP_BAM_BAM_P_RST9_ADDR A:0x678a0004
y.create.l HWIO_BLSP1_BLSP_BAM_BAM_P_HALT0_ADDR A:0x67897008
y.create.l HWIO_BLSP1_BLSP_BAM_BAM_P_HALT1_ADDR A:0x67898008
y.create.l HWIO_BLSP1_BLSP_BAM_BAM_P_HALT2_ADDR A:0x67899008
y.create.l HWIO_BLSP1_BLSP_BAM_BAM_P_HALT3_ADDR A:0x6789a008
y.create.l HWIO_BLSP1_BLSP_BAM_BAM_P_HALT4_ADDR A:0x6789b008
y.create.l HWIO_BLSP1_BLSP_BAM_BAM_P_HALT5_ADDR A:0x6789c008
y.create.l HWIO_BLSP1_BLSP_BAM_BAM_P_HALT6_ADDR A:0x6789d008
y.create.l HWIO_BLSP1_BLSP_BAM_BAM_P_HALT7_ADDR A:0x6789e008
y.create.l HWIO_BLSP1_BLSP_BAM_BAM_P_HALT8_ADDR A:0x6789f008
y.create.l HWIO_BLSP1_BLSP_BAM_BAM_P_HALT9_ADDR A:0x678a0008
y.create.l HWIO_BLSP1_BLSP_BAM_BAM_P_IRQ_STTS0_ADDR A:0x67897010
y.create.l HWIO_BLSP1_BLSP_BAM_BAM_P_IRQ_STTS1_ADDR A:0x67898010
y.create.l HWIO_BLSP1_BLSP_BAM_BAM_P_IRQ_STTS2_ADDR A:0x67899010
y.create.l HWIO_BLSP1_BLSP_BAM_BAM_P_IRQ_STTS3_ADDR A:0x6789a010
y.create.l HWIO_BLSP1_BLSP_BAM_BAM_P_IRQ_STTS4_ADDR A:0x6789b010
y.create.l HWIO_BLSP1_BLSP_BAM_BAM_P_IRQ_STTS5_ADDR A:0x6789c010
y.create.l HWIO_BLSP1_BLSP_BAM_BAM_P_IRQ_STTS6_ADDR A:0x6789d010
y.create.l HWIO_BLSP1_BLSP_BAM_BAM_P_IRQ_STTS7_ADDR A:0x6789e010
y.create.l HWIO_BLSP1_BLSP_BAM_BAM_P_IRQ_STTS8_ADDR A:0x6789f010
y.create.l HWIO_BLSP1_BLSP_BAM_BAM_P_IRQ_STTS9_ADDR A:0x678a0010
y.create.l HWIO_BLSP1_BLSP_BAM_BAM_P_IRQ_CLR0_ADDR A:0x67897014
y.create.l HWIO_BLSP1_BLSP_BAM_BAM_P_IRQ_CLR1_ADDR A:0x67898014
y.create.l HWIO_BLSP1_BLSP_BAM_BAM_P_IRQ_CLR2_ADDR A:0x67899014
y.create.l HWIO_BLSP1_BLSP_BAM_BAM_P_IRQ_CLR3_ADDR A:0x6789a014
y.create.l HWIO_BLSP1_BLSP_BAM_BAM_P_IRQ_CLR4_ADDR A:0x6789b014
y.create.l HWIO_BLSP1_BLSP_BAM_BAM_P_IRQ_CLR5_ADDR A:0x6789c014
y.create.l HWIO_BLSP1_BLSP_BAM_BAM_P_IRQ_CLR6_ADDR A:0x6789d014
y.create.l HWIO_BLSP1_BLSP_BAM_BAM_P_IRQ_CLR7_ADDR A:0x6789e014
y.create.l HWIO_BLSP1_BLSP_BAM_BAM_P_IRQ_CLR8_ADDR A:0x6789f014
y.create.l HWIO_BLSP1_BLSP_BAM_BAM_P_IRQ_CLR9_ADDR A:0x678a0014
y.create.l HWIO_BLSP1_BLSP_BAM_BAM_P_IRQ_EN0_ADDR A:0x67897018
y.create.l HWIO_BLSP1_BLSP_BAM_BAM_P_IRQ_EN1_ADDR A:0x67898018
y.create.l HWIO_BLSP1_BLSP_BAM_BAM_P_IRQ_EN2_ADDR A:0x67899018
y.create.l HWIO_BLSP1_BLSP_BAM_BAM_P_IRQ_EN3_ADDR A:0x6789a018
y.create.l HWIO_BLSP1_BLSP_BAM_BAM_P_IRQ_EN4_ADDR A:0x6789b018
y.create.l HWIO_BLSP1_BLSP_BAM_BAM_P_IRQ_EN5_ADDR A:0x6789c018
y.create.l HWIO_BLSP1_BLSP_BAM_BAM_P_IRQ_EN6_ADDR A:0x6789d018
y.create.l HWIO_BLSP1_BLSP_BAM_BAM_P_IRQ_EN7_ADDR A:0x6789e018
y.create.l HWIO_BLSP1_BLSP_BAM_BAM_P_IRQ_EN8_ADDR A:0x6789f018
y.create.l HWIO_BLSP1_BLSP_BAM_BAM_P_IRQ_EN9_ADDR A:0x678a0018
y.create.l HWIO_BLSP1_BLSP_BAM_BAM_P_TIMER0_ADDR A:0x6789701c
y.create.l HWIO_BLSP1_BLSP_BAM_BAM_P_TIMER1_ADDR A:0x6789801c
y.create.l HWIO_BLSP1_BLSP_BAM_BAM_P_TIMER2_ADDR A:0x6789901c
y.create.l HWIO_BLSP1_BLSP_BAM_BAM_P_TIMER3_ADDR A:0x6789a01c
y.create.l HWIO_BLSP1_BLSP_BAM_BAM_P_TIMER4_ADDR A:0x6789b01c
y.create.l HWIO_BLSP1_BLSP_BAM_BAM_P_TIMER5_ADDR A:0x6789c01c
y.create.l HWIO_BLSP1_BLSP_BAM_BAM_P_TIMER6_ADDR A:0x6789d01c
y.create.l HWIO_BLSP1_BLSP_BAM_BAM_P_TIMER7_ADDR A:0x6789e01c
y.create.l HWIO_BLSP1_BLSP_BAM_BAM_P_TIMER8_ADDR A:0x6789f01c
y.create.l HWIO_BLSP1_BLSP_BAM_BAM_P_TIMER9_ADDR A:0x678a001c
y.create.l HWIO_BLSP1_BLSP_BAM_BAM_P_TIMER_CTRL0_ADDR A:0x67897020
y.create.l HWIO_BLSP1_BLSP_BAM_BAM_P_TIMER_CTRL1_ADDR A:0x67898020
y.create.l HWIO_BLSP1_BLSP_BAM_BAM_P_TIMER_CTRL2_ADDR A:0x67899020
y.create.l HWIO_BLSP1_BLSP_BAM_BAM_P_TIMER_CTRL3_ADDR A:0x6789a020
y.create.l HWIO_BLSP1_BLSP_BAM_BAM_P_TIMER_CTRL4_ADDR A:0x6789b020
y.create.l HWIO_BLSP1_BLSP_BAM_BAM_P_TIMER_CTRL5_ADDR A:0x6789c020
y.create.l HWIO_BLSP1_BLSP_BAM_BAM_P_TIMER_CTRL6_ADDR A:0x6789d020
y.create.l HWIO_BLSP1_BLSP_BAM_BAM_P_TIMER_CTRL7_ADDR A:0x6789e020
y.create.l HWIO_BLSP1_BLSP_BAM_BAM_P_TIMER_CTRL8_ADDR A:0x6789f020
y.create.l HWIO_BLSP1_BLSP_BAM_BAM_P_TIMER_CTRL9_ADDR A:0x678a0020
y.create.l HWIO_BLSP1_BLSP_BAM_BAM_P_PRDCR_SDBND0_ADDR A:0x67897024
y.create.l HWIO_BLSP1_BLSP_BAM_BAM_P_PRDCR_SDBND1_ADDR A:0x67898024
y.create.l HWIO_BLSP1_BLSP_BAM_BAM_P_PRDCR_SDBND2_ADDR A:0x67899024
y.create.l HWIO_BLSP1_BLSP_BAM_BAM_P_PRDCR_SDBND3_ADDR A:0x6789a024
y.create.l HWIO_BLSP1_BLSP_BAM_BAM_P_PRDCR_SDBND4_ADDR A:0x6789b024
y.create.l HWIO_BLSP1_BLSP_BAM_BAM_P_PRDCR_SDBND5_ADDR A:0x6789c024
y.create.l HWIO_BLSP1_BLSP_BAM_BAM_P_PRDCR_SDBND6_ADDR A:0x6789d024
y.create.l HWIO_BLSP1_BLSP_BAM_BAM_P_PRDCR_SDBND7_ADDR A:0x6789e024
y.create.l HWIO_BLSP1_BLSP_BAM_BAM_P_PRDCR_SDBND8_ADDR A:0x6789f024
y.create.l HWIO_BLSP1_BLSP_BAM_BAM_P_PRDCR_SDBND9_ADDR A:0x678a0024
y.create.l HWIO_BLSP1_BLSP_BAM_BAM_P_CNSMR_SDBND0_ADDR A:0x67897028
y.create.l HWIO_BLSP1_BLSP_BAM_BAM_P_CNSMR_SDBND1_ADDR A:0x67898028
y.create.l HWIO_BLSP1_BLSP_BAM_BAM_P_CNSMR_SDBND2_ADDR A:0x67899028
y.create.l HWIO_BLSP1_BLSP_BAM_BAM_P_CNSMR_SDBND3_ADDR A:0x6789a028
y.create.l HWIO_BLSP1_BLSP_BAM_BAM_P_CNSMR_SDBND4_ADDR A:0x6789b028
y.create.l HWIO_BLSP1_BLSP_BAM_BAM_P_CNSMR_SDBND5_ADDR A:0x6789c028
y.create.l HWIO_BLSP1_BLSP_BAM_BAM_P_CNSMR_SDBND6_ADDR A:0x6789d028
y.create.l HWIO_BLSP1_BLSP_BAM_BAM_P_CNSMR_SDBND7_ADDR A:0x6789e028
y.create.l HWIO_BLSP1_BLSP_BAM_BAM_P_CNSMR_SDBND8_ADDR A:0x6789f028
y.create.l HWIO_BLSP1_BLSP_BAM_BAM_P_CNSMR_SDBND9_ADDR A:0x678a0028
y.create.l HWIO_BLSP1_BLSP_BAM_BAM_P_SW_OFSTS0_ADDR A:0x67897800
y.create.l HWIO_BLSP1_BLSP_BAM_BAM_P_SW_OFSTS1_ADDR A:0x67898800
y.create.l HWIO_BLSP1_BLSP_BAM_BAM_P_SW_OFSTS2_ADDR A:0x67899800
y.create.l HWIO_BLSP1_BLSP_BAM_BAM_P_SW_OFSTS3_ADDR A:0x6789a800
y.create.l HWIO_BLSP1_BLSP_BAM_BAM_P_SW_OFSTS4_ADDR A:0x6789b800
y.create.l HWIO_BLSP1_BLSP_BAM_BAM_P_SW_OFSTS5_ADDR A:0x6789c800
y.create.l HWIO_BLSP1_BLSP_BAM_BAM_P_SW_OFSTS6_ADDR A:0x6789d800
y.create.l HWIO_BLSP1_BLSP_BAM_BAM_P_SW_OFSTS7_ADDR A:0x6789e800
y.create.l HWIO_BLSP1_BLSP_BAM_BAM_P_SW_OFSTS8_ADDR A:0x6789f800
y.create.l HWIO_BLSP1_BLSP_BAM_BAM_P_SW_OFSTS9_ADDR A:0x678a0800
y.create.l HWIO_BLSP1_BLSP_BAM_BAM_P_AU_PSM_CNTXT_1_0_ADDR A:0x67897804
y.create.l HWIO_BLSP1_BLSP_BAM_BAM_P_AU_PSM_CNTXT_1_1_ADDR A:0x67898804
y.create.l HWIO_BLSP1_BLSP_BAM_BAM_P_AU_PSM_CNTXT_1_2_ADDR A:0x67899804
y.create.l HWIO_BLSP1_BLSP_BAM_BAM_P_AU_PSM_CNTXT_1_3_ADDR A:0x6789a804
y.create.l HWIO_BLSP1_BLSP_BAM_BAM_P_AU_PSM_CNTXT_1_4_ADDR A:0x6789b804
y.create.l HWIO_BLSP1_BLSP_BAM_BAM_P_AU_PSM_CNTXT_1_5_ADDR A:0x6789c804
y.create.l HWIO_BLSP1_BLSP_BAM_BAM_P_AU_PSM_CNTXT_1_6_ADDR A:0x6789d804
y.create.l HWIO_BLSP1_BLSP_BAM_BAM_P_AU_PSM_CNTXT_1_7_ADDR A:0x6789e804
y.create.l HWIO_BLSP1_BLSP_BAM_BAM_P_AU_PSM_CNTXT_1_8_ADDR A:0x6789f804
y.create.l HWIO_BLSP1_BLSP_BAM_BAM_P_AU_PSM_CNTXT_1_9_ADDR A:0x678a0804
y.create.l HWIO_BLSP1_BLSP_BAM_BAM_P_PSM_CNTXT_2_0_ADDR A:0x67897808
y.create.l HWIO_BLSP1_BLSP_BAM_BAM_P_PSM_CNTXT_2_1_ADDR A:0x67898808
y.create.l HWIO_BLSP1_BLSP_BAM_BAM_P_PSM_CNTXT_2_2_ADDR A:0x67899808
y.create.l HWIO_BLSP1_BLSP_BAM_BAM_P_PSM_CNTXT_2_3_ADDR A:0x6789a808
y.create.l HWIO_BLSP1_BLSP_BAM_BAM_P_PSM_CNTXT_2_4_ADDR A:0x6789b808
y.create.l HWIO_BLSP1_BLSP_BAM_BAM_P_PSM_CNTXT_2_5_ADDR A:0x6789c808
y.create.l HWIO_BLSP1_BLSP_BAM_BAM_P_PSM_CNTXT_2_6_ADDR A:0x6789d808
y.create.l HWIO_BLSP1_BLSP_BAM_BAM_P_PSM_CNTXT_2_7_ADDR A:0x6789e808
y.create.l HWIO_BLSP1_BLSP_BAM_BAM_P_PSM_CNTXT_2_8_ADDR A:0x6789f808
y.create.l HWIO_BLSP1_BLSP_BAM_BAM_P_PSM_CNTXT_2_9_ADDR A:0x678a0808
y.create.l HWIO_BLSP1_BLSP_BAM_BAM_P_PSM_CNTXT_3_0_ADDR A:0x6789780c
y.create.l HWIO_BLSP1_BLSP_BAM_BAM_P_PSM_CNTXT_3_1_ADDR A:0x6789880c
y.create.l HWIO_BLSP1_BLSP_BAM_BAM_P_PSM_CNTXT_3_2_ADDR A:0x6789980c
y.create.l HWIO_BLSP1_BLSP_BAM_BAM_P_PSM_CNTXT_3_3_ADDR A:0x6789a80c
y.create.l HWIO_BLSP1_BLSP_BAM_BAM_P_PSM_CNTXT_3_4_ADDR A:0x6789b80c
y.create.l HWIO_BLSP1_BLSP_BAM_BAM_P_PSM_CNTXT_3_5_ADDR A:0x6789c80c
y.create.l HWIO_BLSP1_BLSP_BAM_BAM_P_PSM_CNTXT_3_6_ADDR A:0x6789d80c
y.create.l HWIO_BLSP1_BLSP_BAM_BAM_P_PSM_CNTXT_3_7_ADDR A:0x6789e80c
y.create.l HWIO_BLSP1_BLSP_BAM_BAM_P_PSM_CNTXT_3_8_ADDR A:0x6789f80c
y.create.l HWIO_BLSP1_BLSP_BAM_BAM_P_PSM_CNTXT_3_9_ADDR A:0x678a080c
y.create.l HWIO_BLSP1_BLSP_BAM_BAM_P_PSM_CNTXT_4_0_ADDR A:0x67897810
y.create.l HWIO_BLSP1_BLSP_BAM_BAM_P_PSM_CNTXT_4_1_ADDR A:0x67898810
y.create.l HWIO_BLSP1_BLSP_BAM_BAM_P_PSM_CNTXT_4_2_ADDR A:0x67899810
y.create.l HWIO_BLSP1_BLSP_BAM_BAM_P_PSM_CNTXT_4_3_ADDR A:0x6789a810
y.create.l HWIO_BLSP1_BLSP_BAM_BAM_P_PSM_CNTXT_4_4_ADDR A:0x6789b810
y.create.l HWIO_BLSP1_BLSP_BAM_BAM_P_PSM_CNTXT_4_5_ADDR A:0x6789c810
y.create.l HWIO_BLSP1_BLSP_BAM_BAM_P_PSM_CNTXT_4_6_ADDR A:0x6789d810
y.create.l HWIO_BLSP1_BLSP_BAM_BAM_P_PSM_CNTXT_4_7_ADDR A:0x6789e810
y.create.l HWIO_BLSP1_BLSP_BAM_BAM_P_PSM_CNTXT_4_8_ADDR A:0x6789f810
y.create.l HWIO_BLSP1_BLSP_BAM_BAM_P_PSM_CNTXT_4_9_ADDR A:0x678a0810
y.create.l HWIO_BLSP1_BLSP_BAM_BAM_P_PSM_CNTXT_5_0_ADDR A:0x67897814
y.create.l HWIO_BLSP1_BLSP_BAM_BAM_P_PSM_CNTXT_5_1_ADDR A:0x67898814
y.create.l HWIO_BLSP1_BLSP_BAM_BAM_P_PSM_CNTXT_5_2_ADDR A:0x67899814
y.create.l HWIO_BLSP1_BLSP_BAM_BAM_P_PSM_CNTXT_5_3_ADDR A:0x6789a814
y.create.l HWIO_BLSP1_BLSP_BAM_BAM_P_PSM_CNTXT_5_4_ADDR A:0x6789b814
y.create.l HWIO_BLSP1_BLSP_BAM_BAM_P_PSM_CNTXT_5_5_ADDR A:0x6789c814
y.create.l HWIO_BLSP1_BLSP_BAM_BAM_P_PSM_CNTXT_5_6_ADDR A:0x6789d814
y.create.l HWIO_BLSP1_BLSP_BAM_BAM_P_PSM_CNTXT_5_7_ADDR A:0x6789e814
y.create.l HWIO_BLSP1_BLSP_BAM_BAM_P_PSM_CNTXT_5_8_ADDR A:0x6789f814
y.create.l HWIO_BLSP1_BLSP_BAM_BAM_P_PSM_CNTXT_5_9_ADDR A:0x678a0814
y.create.l HWIO_BLSP1_BLSP_BAM_BAM_P_EVNT_REG0_ADDR A:0x67897818
y.create.l HWIO_BLSP1_BLSP_BAM_BAM_P_EVNT_REG1_ADDR A:0x67898818
y.create.l HWIO_BLSP1_BLSP_BAM_BAM_P_EVNT_REG2_ADDR A:0x67899818
y.create.l HWIO_BLSP1_BLSP_BAM_BAM_P_EVNT_REG3_ADDR A:0x6789a818
y.create.l HWIO_BLSP1_BLSP_BAM_BAM_P_EVNT_REG4_ADDR A:0x6789b818
y.create.l HWIO_BLSP1_BLSP_BAM_BAM_P_EVNT_REG5_ADDR A:0x6789c818
y.create.l HWIO_BLSP1_BLSP_BAM_BAM_P_EVNT_REG6_ADDR A:0x6789d818
y.create.l HWIO_BLSP1_BLSP_BAM_BAM_P_EVNT_REG7_ADDR A:0x6789e818
y.create.l HWIO_BLSP1_BLSP_BAM_BAM_P_EVNT_REG8_ADDR A:0x6789f818
y.create.l HWIO_BLSP1_BLSP_BAM_BAM_P_EVNT_REG9_ADDR A:0x678a0818
y.create.l HWIO_BLSP1_BLSP_BAM_BAM_P_DESC_FIFO_ADDR0_ADDR A:0x6789781c
y.create.l HWIO_BLSP1_BLSP_BAM_BAM_P_DESC_FIFO_ADDR1_ADDR A:0x6789881c
y.create.l HWIO_BLSP1_BLSP_BAM_BAM_P_DESC_FIFO_ADDR2_ADDR A:0x6789981c
y.create.l HWIO_BLSP1_BLSP_BAM_BAM_P_DESC_FIFO_ADDR3_ADDR A:0x6789a81c
y.create.l HWIO_BLSP1_BLSP_BAM_BAM_P_DESC_FIFO_ADDR4_ADDR A:0x6789b81c
y.create.l HWIO_BLSP1_BLSP_BAM_BAM_P_DESC_FIFO_ADDR5_ADDR A:0x6789c81c
y.create.l HWIO_BLSP1_BLSP_BAM_BAM_P_DESC_FIFO_ADDR6_ADDR A:0x6789d81c
y.create.l HWIO_BLSP1_BLSP_BAM_BAM_P_DESC_FIFO_ADDR7_ADDR A:0x6789e81c
y.create.l HWIO_BLSP1_BLSP_BAM_BAM_P_DESC_FIFO_ADDR8_ADDR A:0x6789f81c
y.create.l HWIO_BLSP1_BLSP_BAM_BAM_P_DESC_FIFO_ADDR9_ADDR A:0x678a081c
y.create.l HWIO_BLSP1_BLSP_BAM_BAM_P_FIFO_SIZES0_ADDR A:0x67897820
y.create.l HWIO_BLSP1_BLSP_BAM_BAM_P_FIFO_SIZES1_ADDR A:0x67898820
y.create.l HWIO_BLSP1_BLSP_BAM_BAM_P_FIFO_SIZES2_ADDR A:0x67899820
y.create.l HWIO_BLSP1_BLSP_BAM_BAM_P_FIFO_SIZES3_ADDR A:0x6789a820
y.create.l HWIO_BLSP1_BLSP_BAM_BAM_P_FIFO_SIZES4_ADDR A:0x6789b820
y.create.l HWIO_BLSP1_BLSP_BAM_BAM_P_FIFO_SIZES5_ADDR A:0x6789c820
y.create.l HWIO_BLSP1_BLSP_BAM_BAM_P_FIFO_SIZES6_ADDR A:0x6789d820
y.create.l HWIO_BLSP1_BLSP_BAM_BAM_P_FIFO_SIZES7_ADDR A:0x6789e820
y.create.l HWIO_BLSP1_BLSP_BAM_BAM_P_FIFO_SIZES8_ADDR A:0x6789f820
y.create.l HWIO_BLSP1_BLSP_BAM_BAM_P_FIFO_SIZES9_ADDR A:0x678a0820
y.create.l HWIO_BLSP1_BLSP_BAM_BAM_P_DATA_FIFO_ADDR0_ADDR A:0x67897824
y.create.l HWIO_BLSP1_BLSP_BAM_BAM_P_DATA_FIFO_ADDR1_ADDR A:0x67898824
y.create.l HWIO_BLSP1_BLSP_BAM_BAM_P_DATA_FIFO_ADDR2_ADDR A:0x67899824
y.create.l HWIO_BLSP1_BLSP_BAM_BAM_P_DATA_FIFO_ADDR3_ADDR A:0x6789a824
y.create.l HWIO_BLSP1_BLSP_BAM_BAM_P_DATA_FIFO_ADDR4_ADDR A:0x6789b824
y.create.l HWIO_BLSP1_BLSP_BAM_BAM_P_DATA_FIFO_ADDR5_ADDR A:0x6789c824
y.create.l HWIO_BLSP1_BLSP_BAM_BAM_P_DATA_FIFO_ADDR6_ADDR A:0x6789d824
y.create.l HWIO_BLSP1_BLSP_BAM_BAM_P_DATA_FIFO_ADDR7_ADDR A:0x6789e824
y.create.l HWIO_BLSP1_BLSP_BAM_BAM_P_DATA_FIFO_ADDR8_ADDR A:0x6789f824
y.create.l HWIO_BLSP1_BLSP_BAM_BAM_P_DATA_FIFO_ADDR9_ADDR A:0x678a0824
y.create.l HWIO_BLSP1_BLSP_BAM_BAM_P_EVNT_GEN_TRSHLD0_ADDR A:0x67897828
y.create.l HWIO_BLSP1_BLSP_BAM_BAM_P_EVNT_GEN_TRSHLD1_ADDR A:0x67898828
y.create.l HWIO_BLSP1_BLSP_BAM_BAM_P_EVNT_GEN_TRSHLD2_ADDR A:0x67899828
y.create.l HWIO_BLSP1_BLSP_BAM_BAM_P_EVNT_GEN_TRSHLD3_ADDR A:0x6789a828
y.create.l HWIO_BLSP1_BLSP_BAM_BAM_P_EVNT_GEN_TRSHLD4_ADDR A:0x6789b828
y.create.l HWIO_BLSP1_BLSP_BAM_BAM_P_EVNT_GEN_TRSHLD5_ADDR A:0x6789c828
y.create.l HWIO_BLSP1_BLSP_BAM_BAM_P_EVNT_GEN_TRSHLD6_ADDR A:0x6789d828
y.create.l HWIO_BLSP1_BLSP_BAM_BAM_P_EVNT_GEN_TRSHLD7_ADDR A:0x6789e828
y.create.l HWIO_BLSP1_BLSP_BAM_BAM_P_EVNT_GEN_TRSHLD8_ADDR A:0x6789f828
y.create.l HWIO_BLSP1_BLSP_BAM_BAM_P_EVNT_GEN_TRSHLD9_ADDR A:0x678a0828
y.create.l HWIO_BLSP1_BLSP_BAM_BAM_P_EVNT_DEST_ADDR0_ADDR A:0x6789782c
y.create.l HWIO_BLSP1_BLSP_BAM_BAM_P_EVNT_DEST_ADDR1_ADDR A:0x6789882c
y.create.l HWIO_BLSP1_BLSP_BAM_BAM_P_EVNT_DEST_ADDR2_ADDR A:0x6789982c
y.create.l HWIO_BLSP1_BLSP_BAM_BAM_P_EVNT_DEST_ADDR3_ADDR A:0x6789a82c
y.create.l HWIO_BLSP1_BLSP_BAM_BAM_P_EVNT_DEST_ADDR4_ADDR A:0x6789b82c
y.create.l HWIO_BLSP1_BLSP_BAM_BAM_P_EVNT_DEST_ADDR5_ADDR A:0x6789c82c
y.create.l HWIO_BLSP1_BLSP_BAM_BAM_P_EVNT_DEST_ADDR6_ADDR A:0x6789d82c
y.create.l HWIO_BLSP1_BLSP_BAM_BAM_P_EVNT_DEST_ADDR7_ADDR A:0x6789e82c
y.create.l HWIO_BLSP1_BLSP_BAM_BAM_P_EVNT_DEST_ADDR8_ADDR A:0x6789f82c
y.create.l HWIO_BLSP1_BLSP_BAM_BAM_P_EVNT_DEST_ADDR9_ADDR A:0x678a082c
y.create.l HWIO_BLSP1_BLSP_BAM_BAM_P_DF_CNTXT_0_ADDR A:0x67897830
y.create.l HWIO_BLSP1_BLSP_BAM_BAM_P_DF_CNTXT_1_ADDR A:0x67898830
y.create.l HWIO_BLSP1_BLSP_BAM_BAM_P_DF_CNTXT_2_ADDR A:0x67899830
y.create.l HWIO_BLSP1_BLSP_BAM_BAM_P_DF_CNTXT_3_ADDR A:0x6789a830
y.create.l HWIO_BLSP1_BLSP_BAM_BAM_P_DF_CNTXT_4_ADDR A:0x6789b830
y.create.l HWIO_BLSP1_BLSP_BAM_BAM_P_DF_CNTXT_5_ADDR A:0x6789c830
y.create.l HWIO_BLSP1_BLSP_BAM_BAM_P_DF_CNTXT_6_ADDR A:0x6789d830
y.create.l HWIO_BLSP1_BLSP_BAM_BAM_P_DF_CNTXT_7_ADDR A:0x6789e830
y.create.l HWIO_BLSP1_BLSP_BAM_BAM_P_DF_CNTXT_8_ADDR A:0x6789f830
y.create.l HWIO_BLSP1_BLSP_BAM_BAM_P_DF_CNTXT_9_ADDR A:0x678a0830
y.create.l HWIO_BLSP1_BLSP_BAM_BAM_P_RETR_CNTXT_0_ADDR A:0x67897834
y.create.l HWIO_BLSP1_BLSP_BAM_BAM_P_RETR_CNTXT_1_ADDR A:0x67898834
y.create.l HWIO_BLSP1_BLSP_BAM_BAM_P_RETR_CNTXT_2_ADDR A:0x67899834
y.create.l HWIO_BLSP1_BLSP_BAM_BAM_P_RETR_CNTXT_3_ADDR A:0x6789a834
y.create.l HWIO_BLSP1_BLSP_BAM_BAM_P_RETR_CNTXT_4_ADDR A:0x6789b834
y.create.l HWIO_BLSP1_BLSP_BAM_BAM_P_RETR_CNTXT_5_ADDR A:0x6789c834
y.create.l HWIO_BLSP1_BLSP_BAM_BAM_P_RETR_CNTXT_6_ADDR A:0x6789d834
y.create.l HWIO_BLSP1_BLSP_BAM_BAM_P_RETR_CNTXT_7_ADDR A:0x6789e834
y.create.l HWIO_BLSP1_BLSP_BAM_BAM_P_RETR_CNTXT_8_ADDR A:0x6789f834
y.create.l HWIO_BLSP1_BLSP_BAM_BAM_P_RETR_CNTXT_9_ADDR A:0x678a0834
y.create.l HWIO_BLSP1_BLSP_BAM_BAM_P_SI_CNTXT_0_ADDR A:0x67897838
y.create.l HWIO_BLSP1_BLSP_BAM_BAM_P_SI_CNTXT_1_ADDR A:0x67898838
y.create.l HWIO_BLSP1_BLSP_BAM_BAM_P_SI_CNTXT_2_ADDR A:0x67899838
y.create.l HWIO_BLSP1_BLSP_BAM_BAM_P_SI_CNTXT_3_ADDR A:0x6789a838
y.create.l HWIO_BLSP1_BLSP_BAM_BAM_P_SI_CNTXT_4_ADDR A:0x6789b838
y.create.l HWIO_BLSP1_BLSP_BAM_BAM_P_SI_CNTXT_5_ADDR A:0x6789c838
y.create.l HWIO_BLSP1_BLSP_BAM_BAM_P_SI_CNTXT_6_ADDR A:0x6789d838
y.create.l HWIO_BLSP1_BLSP_BAM_BAM_P_SI_CNTXT_7_ADDR A:0x6789e838
y.create.l HWIO_BLSP1_BLSP_BAM_BAM_P_SI_CNTXT_8_ADDR A:0x6789f838
y.create.l HWIO_BLSP1_BLSP_BAM_BAM_P_SI_CNTXT_9_ADDR A:0x678a0838
y.create.l HWIO_BLSP1_BLSP_BAM_BAM_P_PSM_CNTXT_3_LSB0_ADDR A:0x67897900
y.create.l HWIO_BLSP1_BLSP_BAM_BAM_P_PSM_CNTXT_3_LSB1_ADDR A:0x67898900
y.create.l HWIO_BLSP1_BLSP_BAM_BAM_P_PSM_CNTXT_3_LSB2_ADDR A:0x67899900
y.create.l HWIO_BLSP1_BLSP_BAM_BAM_P_PSM_CNTXT_3_LSB3_ADDR A:0x6789a900
y.create.l HWIO_BLSP1_BLSP_BAM_BAM_P_PSM_CNTXT_3_LSB4_ADDR A:0x6789b900
y.create.l HWIO_BLSP1_BLSP_BAM_BAM_P_PSM_CNTXT_3_LSB5_ADDR A:0x6789c900
y.create.l HWIO_BLSP1_BLSP_BAM_BAM_P_PSM_CNTXT_3_LSB6_ADDR A:0x6789d900
y.create.l HWIO_BLSP1_BLSP_BAM_BAM_P_PSM_CNTXT_3_LSB7_ADDR A:0x6789e900
y.create.l HWIO_BLSP1_BLSP_BAM_BAM_P_PSM_CNTXT_3_LSB8_ADDR A:0x6789f900
y.create.l HWIO_BLSP1_BLSP_BAM_BAM_P_PSM_CNTXT_3_LSB9_ADDR A:0x678a0900
y.create.l HWIO_BLSP1_BLSP_BAM_BAM_P_PSM_CNTXT_3_MSB0_ADDR A:0x67897904
y.create.l HWIO_BLSP1_BLSP_BAM_BAM_P_PSM_CNTXT_3_MSB1_ADDR A:0x67898904
y.create.l HWIO_BLSP1_BLSP_BAM_BAM_P_PSM_CNTXT_3_MSB2_ADDR A:0x67899904
y.create.l HWIO_BLSP1_BLSP_BAM_BAM_P_PSM_CNTXT_3_MSB3_ADDR A:0x6789a904
y.create.l HWIO_BLSP1_BLSP_BAM_BAM_P_PSM_CNTXT_3_MSB4_ADDR A:0x6789b904
y.create.l HWIO_BLSP1_BLSP_BAM_BAM_P_PSM_CNTXT_3_MSB5_ADDR A:0x6789c904
y.create.l HWIO_BLSP1_BLSP_BAM_BAM_P_PSM_CNTXT_3_MSB6_ADDR A:0x6789d904
y.create.l HWIO_BLSP1_BLSP_BAM_BAM_P_PSM_CNTXT_3_MSB7_ADDR A:0x6789e904
y.create.l HWIO_BLSP1_BLSP_BAM_BAM_P_PSM_CNTXT_3_MSB8_ADDR A:0x6789f904
y.create.l HWIO_BLSP1_BLSP_BAM_BAM_P_PSM_CNTXT_3_MSB9_ADDR A:0x678a0904
y.create.l HWIO_BLSP1_BLSP_BAM_BAM_P_DESC_FIFO_ADDR_LSB0_ADDR A:0x67897910
y.create.l HWIO_BLSP1_BLSP_BAM_BAM_P_DESC_FIFO_ADDR_LSB1_ADDR A:0x67898910
y.create.l HWIO_BLSP1_BLSP_BAM_BAM_P_DESC_FIFO_ADDR_LSB2_ADDR A:0x67899910
y.create.l HWIO_BLSP1_BLSP_BAM_BAM_P_DESC_FIFO_ADDR_LSB3_ADDR A:0x6789a910
y.create.l HWIO_BLSP1_BLSP_BAM_BAM_P_DESC_FIFO_ADDR_LSB4_ADDR A:0x6789b910
y.create.l HWIO_BLSP1_BLSP_BAM_BAM_P_DESC_FIFO_ADDR_LSB5_ADDR A:0x6789c910
y.create.l HWIO_BLSP1_BLSP_BAM_BAM_P_DESC_FIFO_ADDR_LSB6_ADDR A:0x6789d910
y.create.l HWIO_BLSP1_BLSP_BAM_BAM_P_DESC_FIFO_ADDR_LSB7_ADDR A:0x6789e910
y.create.l HWIO_BLSP1_BLSP_BAM_BAM_P_DESC_FIFO_ADDR_LSB8_ADDR A:0x6789f910
y.create.l HWIO_BLSP1_BLSP_BAM_BAM_P_DESC_FIFO_ADDR_LSB9_ADDR A:0x678a0910
y.create.l HWIO_BLSP1_BLSP_BAM_BAM_P_DESC_FIFO_ADDR_MSB0_ADDR A:0x67897914
y.create.l HWIO_BLSP1_BLSP_BAM_BAM_P_DESC_FIFO_ADDR_MSB1_ADDR A:0x67898914
y.create.l HWIO_BLSP1_BLSP_BAM_BAM_P_DESC_FIFO_ADDR_MSB2_ADDR A:0x67899914
y.create.l HWIO_BLSP1_BLSP_BAM_BAM_P_DESC_FIFO_ADDR_MSB3_ADDR A:0x6789a914
y.create.l HWIO_BLSP1_BLSP_BAM_BAM_P_DESC_FIFO_ADDR_MSB4_ADDR A:0x6789b914
y.create.l HWIO_BLSP1_BLSP_BAM_BAM_P_DESC_FIFO_ADDR_MSB5_ADDR A:0x6789c914
y.create.l HWIO_BLSP1_BLSP_BAM_BAM_P_DESC_FIFO_ADDR_MSB6_ADDR A:0x6789d914
y.create.l HWIO_BLSP1_BLSP_BAM_BAM_P_DESC_FIFO_ADDR_MSB7_ADDR A:0x6789e914
y.create.l HWIO_BLSP1_BLSP_BAM_BAM_P_DESC_FIFO_ADDR_MSB8_ADDR A:0x6789f914
y.create.l HWIO_BLSP1_BLSP_BAM_BAM_P_DESC_FIFO_ADDR_MSB9_ADDR A:0x678a0914
y.create.l HWIO_BLSP1_BLSP_BAM_BAM_P_DATA_FIFO_ADDR_LSB0_ADDR A:0x67897920
y.create.l HWIO_BLSP1_BLSP_BAM_BAM_P_DATA_FIFO_ADDR_LSB1_ADDR A:0x67898920
y.create.l HWIO_BLSP1_BLSP_BAM_BAM_P_DATA_FIFO_ADDR_LSB2_ADDR A:0x67899920
y.create.l HWIO_BLSP1_BLSP_BAM_BAM_P_DATA_FIFO_ADDR_LSB3_ADDR A:0x6789a920
y.create.l HWIO_BLSP1_BLSP_BAM_BAM_P_DATA_FIFO_ADDR_LSB4_ADDR A:0x6789b920
y.create.l HWIO_BLSP1_BLSP_BAM_BAM_P_DATA_FIFO_ADDR_LSB5_ADDR A:0x6789c920
y.create.l HWIO_BLSP1_BLSP_BAM_BAM_P_DATA_FIFO_ADDR_LSB6_ADDR A:0x6789d920
y.create.l HWIO_BLSP1_BLSP_BAM_BAM_P_DATA_FIFO_ADDR_LSB7_ADDR A:0x6789e920
y.create.l HWIO_BLSP1_BLSP_BAM_BAM_P_DATA_FIFO_ADDR_LSB8_ADDR A:0x6789f920
y.create.l HWIO_BLSP1_BLSP_BAM_BAM_P_DATA_FIFO_ADDR_LSB9_ADDR A:0x678a0920
y.create.l HWIO_BLSP1_BLSP_BAM_BAM_P_DATA_FIFO_ADDR_MSB0_ADDR A:0x67897924
y.create.l HWIO_BLSP1_BLSP_BAM_BAM_P_DATA_FIFO_ADDR_MSB1_ADDR A:0x67898924
y.create.l HWIO_BLSP1_BLSP_BAM_BAM_P_DATA_FIFO_ADDR_MSB2_ADDR A:0x67899924
y.create.l HWIO_BLSP1_BLSP_BAM_BAM_P_DATA_FIFO_ADDR_MSB3_ADDR A:0x6789a924
y.create.l HWIO_BLSP1_BLSP_BAM_BAM_P_DATA_FIFO_ADDR_MSB4_ADDR A:0x6789b924
y.create.l HWIO_BLSP1_BLSP_BAM_BAM_P_DATA_FIFO_ADDR_MSB5_ADDR A:0x6789c924
y.create.l HWIO_BLSP1_BLSP_BAM_BAM_P_DATA_FIFO_ADDR_MSB6_ADDR A:0x6789d924
y.create.l HWIO_BLSP1_BLSP_BAM_BAM_P_DATA_FIFO_ADDR_MSB7_ADDR A:0x6789e924
y.create.l HWIO_BLSP1_BLSP_BAM_BAM_P_DATA_FIFO_ADDR_MSB8_ADDR A:0x6789f924
y.create.l HWIO_BLSP1_BLSP_BAM_BAM_P_DATA_FIFO_ADDR_MSB9_ADDR A:0x678a0924
y.create.l HWIO_BLSP1_BLSP_BAM_BAM_P_EVNT_DEST_ADDR_LSB0_ADDR A:0x67897930
y.create.l HWIO_BLSP1_BLSP_BAM_BAM_P_EVNT_DEST_ADDR_LSB1_ADDR A:0x67898930
y.create.l HWIO_BLSP1_BLSP_BAM_BAM_P_EVNT_DEST_ADDR_LSB2_ADDR A:0x67899930
y.create.l HWIO_BLSP1_BLSP_BAM_BAM_P_EVNT_DEST_ADDR_LSB3_ADDR A:0x6789a930
y.create.l HWIO_BLSP1_BLSP_BAM_BAM_P_EVNT_DEST_ADDR_LSB4_ADDR A:0x6789b930
y.create.l HWIO_BLSP1_BLSP_BAM_BAM_P_EVNT_DEST_ADDR_LSB5_ADDR A:0x6789c930
y.create.l HWIO_BLSP1_BLSP_BAM_BAM_P_EVNT_DEST_ADDR_LSB6_ADDR A:0x6789d930
y.create.l HWIO_BLSP1_BLSP_BAM_BAM_P_EVNT_DEST_ADDR_LSB7_ADDR A:0x6789e930
y.create.l HWIO_BLSP1_BLSP_BAM_BAM_P_EVNT_DEST_ADDR_LSB8_ADDR A:0x6789f930
y.create.l HWIO_BLSP1_BLSP_BAM_BAM_P_EVNT_DEST_ADDR_LSB9_ADDR A:0x678a0930
y.create.l HWIO_BLSP1_BLSP_BAM_BAM_P_EVNT_DEST_ADDR_MSB0_ADDR A:0x67897934
y.create.l HWIO_BLSP1_BLSP_BAM_BAM_P_EVNT_DEST_ADDR_MSB1_ADDR A:0x67898934
y.create.l HWIO_BLSP1_BLSP_BAM_BAM_P_EVNT_DEST_ADDR_MSB2_ADDR A:0x67899934
y.create.l HWIO_BLSP1_BLSP_BAM_BAM_P_EVNT_DEST_ADDR_MSB3_ADDR A:0x6789a934
y.create.l HWIO_BLSP1_BLSP_BAM_BAM_P_EVNT_DEST_ADDR_MSB4_ADDR A:0x6789b934
y.create.l HWIO_BLSP1_BLSP_BAM_BAM_P_EVNT_DEST_ADDR_MSB5_ADDR A:0x6789c934
y.create.l HWIO_BLSP1_BLSP_BAM_BAM_P_EVNT_DEST_ADDR_MSB6_ADDR A:0x6789d934
y.create.l HWIO_BLSP1_BLSP_BAM_BAM_P_EVNT_DEST_ADDR_MSB7_ADDR A:0x6789e934
y.create.l HWIO_BLSP1_BLSP_BAM_BAM_P_EVNT_DEST_ADDR_MSB8_ADDR A:0x6789f934
y.create.l HWIO_BLSP1_BLSP_BAM_BAM_P_EVNT_DEST_ADDR_MSB9_ADDR A:0x678a0934
y.create.l HWIO_BLSP1_BLSP_BAM_XPU_SCR_ADDR A:0x67882000
y.create.l HWIO_BLSP1_BLSP_BAM_XPU_SWDR_ADDR A:0x67882004
y.create.l HWIO_BLSP1_BLSP_BAM_XPU_SEAR0_ADDR A:0x67882040
y.create.l HWIO_BLSP1_BLSP_BAM_XPU_SESR_ADDR A:0x67882048
y.create.l HWIO_BLSP1_BLSP_BAM_XPU_SESRRESTORE_ADDR A:0x6788204c
y.create.l HWIO_BLSP1_BLSP_BAM_XPU_SESYNR0_ADDR A:0x67882050
y.create.l HWIO_BLSP1_BLSP_BAM_XPU_SESYNR1_ADDR A:0x67882054
y.create.l HWIO_BLSP1_BLSP_BAM_XPU_SESYNR2_ADDR A:0x67882058
y.create.l HWIO_BLSP1_BLSP_BAM_XPU_MCR_ADDR A:0x67882100
y.create.l HWIO_BLSP1_BLSP_BAM_XPU_MEAR0_ADDR A:0x67882140
y.create.l HWIO_BLSP1_BLSP_BAM_XPU_MESR_ADDR A:0x67882148
y.create.l HWIO_BLSP1_BLSP_BAM_XPU_MESRRESTORE_ADDR A:0x6788214c
y.create.l HWIO_BLSP1_BLSP_BAM_XPU_MESYNR0_ADDR A:0x67882150
y.create.l HWIO_BLSP1_BLSP_BAM_XPU_MESYNR1_ADDR A:0x67882154
y.create.l HWIO_BLSP1_BLSP_BAM_XPU_MESYNR2_ADDR A:0x67882158
y.create.l HWIO_BLSP1_BLSP_BAM_XPU_CR_ADDR A:0x67882080
y.create.l HWIO_BLSP1_BLSP_BAM_XPU_RPU_ACR0_ADDR A:0x678820a0
y.create.l HWIO_BLSP1_BLSP_BAM_XPU_EAR0_ADDR A:0x678820c0
y.create.l HWIO_BLSP1_BLSP_BAM_XPU_ESR_ADDR A:0x678820c8
y.create.l HWIO_BLSP1_BLSP_BAM_XPU_ESRRESTORE_ADDR A:0x678820cc
y.create.l HWIO_BLSP1_BLSP_BAM_XPU_ESYNR0_ADDR A:0x678820d0
y.create.l HWIO_BLSP1_BLSP_BAM_XPU_ESYNR1_ADDR A:0x678820d4
y.create.l HWIO_BLSP1_BLSP_BAM_XPU_ESYNR2_ADDR A:0x678820d8
y.create.l HWIO_BLSP1_BLSP_BAM_XPU_IDR0_ADDR A:0x67882074
y.create.l HWIO_BLSP1_BLSP_BAM_XPU_IDR1_ADDR A:0x67882078
y.create.l HWIO_BLSP1_BLSP_BAM_XPU_REV_ADDR A:0x6788207c
y.create.l HWIO_BLSP1_BLSP_BAM_XPU_RG0_RACR0_ADDR A:0x67882200
y.create.l HWIO_BLSP1_BLSP_BAM_XPU_RG1_RACR0_ADDR A:0x67882280
y.create.l HWIO_BLSP1_BLSP_BAM_XPU_RG2_RACR0_ADDR A:0x67882300
y.create.l HWIO_BLSP1_BLSP_BAM_XPU_RG3_RACR0_ADDR A:0x67882380
y.create.l HWIO_BLSP1_BLSP_BAM_XPU_RG4_RACR0_ADDR A:0x67882400
y.create.l HWIO_BLSP1_BLSP_BAM_XPU_RG5_RACR0_ADDR A:0x67882480
y.create.l HWIO_BLSP1_BLSP_BAM_XPU_RG6_RACR0_ADDR A:0x67882500
y.create.l HWIO_BLSP1_BLSP_BAM_XPU_RG7_RACR0_ADDR A:0x67882580
y.create.l HWIO_BLSP1_BLSP_BAM_XPU_RG8_RACR0_ADDR A:0x67882600
y.create.l HWIO_BLSP1_BLSP_BAM_XPU_RG9_RACR0_ADDR A:0x67882680
y.create.l HWIO_BLSP1_BLSP_BAM_XPU_RG0_SCR_ADDR A:0x67882250
y.create.l HWIO_BLSP1_BLSP_BAM_XPU_RG1_SCR_ADDR A:0x678822d0
y.create.l HWIO_BLSP1_BLSP_BAM_XPU_RG2_SCR_ADDR A:0x67882350
y.create.l HWIO_BLSP1_BLSP_BAM_XPU_RG3_SCR_ADDR A:0x678823d0
y.create.l HWIO_BLSP1_BLSP_BAM_XPU_RG4_SCR_ADDR A:0x67882450
y.create.l HWIO_BLSP1_BLSP_BAM_XPU_RG5_SCR_ADDR A:0x678824d0
y.create.l HWIO_BLSP1_BLSP_BAM_XPU_RG6_SCR_ADDR A:0x67882550
y.create.l HWIO_BLSP1_BLSP_BAM_XPU_RG7_SCR_ADDR A:0x678825d0
y.create.l HWIO_BLSP1_BLSP_BAM_XPU_RG8_SCR_ADDR A:0x67882650
y.create.l HWIO_BLSP1_BLSP_BAM_XPU_RG9_SCR_ADDR A:0x678826d0
y.create.l HWIO_BLSP1_BLSP_BAM_XPU_RG0_MCR_ADDR A:0x67882254
y.create.l HWIO_BLSP1_BLSP_BAM_XPU_RG1_MCR_ADDR A:0x678822d4
y.create.l HWIO_BLSP1_BLSP_BAM_XPU_RG2_MCR_ADDR A:0x67882354
y.create.l HWIO_BLSP1_BLSP_BAM_XPU_RG3_MCR_ADDR A:0x678823d4
y.create.l HWIO_BLSP1_BLSP_BAM_XPU_RG4_MCR_ADDR A:0x67882454
y.create.l HWIO_BLSP1_BLSP_BAM_XPU_RG5_MCR_ADDR A:0x678824d4
y.create.l HWIO_BLSP1_BLSP_BAM_XPU_RG6_MCR_ADDR A:0x67882554
y.create.l HWIO_BLSP1_BLSP_BAM_XPU_RG7_MCR_ADDR A:0x678825d4
y.create.l HWIO_BLSP1_BLSP_BAM_XPU_RG8_MCR_ADDR A:0x67882654
y.create.l HWIO_BLSP1_BLSP_BAM_XPU_RG9_MCR_ADDR A:0x678826d4
y.create.l HWIO_BLSP1_BLSP_BAM_VMIDMT_SCR0_ADDR A:0x67880000
y.create.l HWIO_BLSP1_BLSP_BAM_VMIDMT_SCR1_ADDR A:0x67880004
y.create.l HWIO_BLSP1_BLSP_BAM_VMIDMT_SCR2_ADDR A:0x67880008
y.create.l HWIO_BLSP1_BLSP_BAM_VMIDMT_SACR_ADDR A:0x67880010
y.create.l HWIO_BLSP1_BLSP_BAM_VMIDMT_SIDR0_ADDR A:0x67880020
y.create.l HWIO_BLSP1_BLSP_BAM_VMIDMT_SIDR1_ADDR A:0x67880024
y.create.l HWIO_BLSP1_BLSP_BAM_VMIDMT_SIDR2_ADDR A:0x67880028
y.create.l HWIO_BLSP1_BLSP_BAM_VMIDMT_SIDR4_ADDR A:0x67880030
y.create.l HWIO_BLSP1_BLSP_BAM_VMIDMT_SIDR5_ADDR A:0x67880034
y.create.l HWIO_BLSP1_BLSP_BAM_VMIDMT_SIDR7_ADDR A:0x6788003c
y.create.l HWIO_BLSP1_BLSP_BAM_VMIDMT_SGFAR0_ADDR A:0x67880040
y.create.l HWIO_BLSP1_BLSP_BAM_VMIDMT_SGFSR_ADDR A:0x67880048
y.create.l HWIO_BLSP1_BLSP_BAM_VMIDMT_SGFSRRESTORE_ADDR A:0x6788004c
y.create.l HWIO_BLSP1_BLSP_BAM_VMIDMT_SGFSYNDR0_ADDR A:0x67880050
y.create.l HWIO_BLSP1_BLSP_BAM_VMIDMT_SGFSYNDR1_ADDR A:0x67880054
y.create.l HWIO_BLSP1_BLSP_BAM_VMIDMT_SGFSYNDR2_ADDR A:0x67880058
y.create.l HWIO_BLSP1_BLSP_BAM_VMIDMT_VMIDMTSCR0_ADDR A:0x67880090
y.create.l HWIO_BLSP1_BLSP_BAM_VMIDMT_CR0_ADDR A:0x67880000
y.create.l HWIO_BLSP1_BLSP_BAM_VMIDMT_CR2_ADDR A:0x67880008
y.create.l HWIO_BLSP1_BLSP_BAM_VMIDMT_ACR_ADDR A:0x67880010
y.create.l HWIO_BLSP1_BLSP_BAM_VMIDMT_IDR0_ADDR A:0x67880020
y.create.l HWIO_BLSP1_BLSP_BAM_VMIDMT_IDR1_ADDR A:0x67880024
y.create.l HWIO_BLSP1_BLSP_BAM_VMIDMT_IDR2_ADDR A:0x67880028
y.create.l HWIO_BLSP1_BLSP_BAM_VMIDMT_IDR4_ADDR A:0x67880030
y.create.l HWIO_BLSP1_BLSP_BAM_VMIDMT_IDR5_ADDR A:0x67880034
y.create.l HWIO_BLSP1_BLSP_BAM_VMIDMT_IDR7_ADDR A:0x6788003c
y.create.l HWIO_BLSP1_BLSP_BAM_VMIDMT_GFAR0_ADDR A:0x67880040
y.create.l HWIO_BLSP1_BLSP_BAM_VMIDMT_GFSR_ADDR A:0x67880048
y.create.l HWIO_BLSP1_BLSP_BAM_VMIDMT_GFSRRESTORE_ADDR A:0x6788004c
y.create.l HWIO_BLSP1_BLSP_BAM_VMIDMT_GFSYNDR0_ADDR A:0x67880050
y.create.l HWIO_BLSP1_BLSP_BAM_VMIDMT_GFSYNDR1_ADDR A:0x67880054
y.create.l HWIO_BLSP1_BLSP_BAM_VMIDMT_GFSYNDR2_ADDR A:0x67880058
y.create.l HWIO_BLSP1_BLSP_BAM_VMIDMT_VMIDMTCR0_ADDR A:0x67880090
y.create.l HWIO_BLSP1_BLSP_BAM_VMIDMT_VMIDMTACR_ADDR A:0x6788009c
y.create.l HWIO_BLSP1_BLSP_BAM_VMIDMT_NSCR0_ADDR A:0x67880400
y.create.l HWIO_BLSP1_BLSP_BAM_VMIDMT_NSCR2_ADDR A:0x67880408
y.create.l HWIO_BLSP1_BLSP_BAM_VMIDMT_NSACR_ADDR A:0x67880410
y.create.l HWIO_BLSP1_BLSP_BAM_VMIDMT_NSGFAR0_ADDR A:0x67880440
y.create.l HWIO_BLSP1_BLSP_BAM_VMIDMT_NSGFSR_ADDR A:0x67880448
y.create.l HWIO_BLSP1_BLSP_BAM_VMIDMT_NSGFSRRESTORE_ADDR A:0x6788044c
y.create.l HWIO_BLSP1_BLSP_BAM_VMIDMT_NSGFSYNDR0_ADDR A:0x67880450
y.create.l HWIO_BLSP1_BLSP_BAM_VMIDMT_NSGFSYNDR1_ADDR A:0x67880454
y.create.l HWIO_BLSP1_BLSP_BAM_VMIDMT_NSGFSYNDR2_ADDR A:0x67880458
y.create.l HWIO_BLSP1_BLSP_BAM_VMIDMT_NSVMIDMTCR0_ADDR A:0x67880490
y.create.l HWIO_BLSP1_BLSP_BAM_VMIDMT_SSDR0_ADDR A:0x67880080
y.create.l HWIO_BLSP1_BLSP_BAM_VMIDMT_MSDR0_ADDR A:0x67880480
y.create.l HWIO_BLSP1_BLSP_BAM_VMIDMT_MCR_ADDR A:0x67880494
y.create.l HWIO_BLSP1_BLSP_BAM_VMIDMT_S2VR0_ADDR A:0x67880c00
y.create.l HWIO_BLSP1_BLSP_BAM_VMIDMT_S2VR1_ADDR A:0x67880c04
y.create.l HWIO_BLSP1_BLSP_BAM_VMIDMT_S2VR2_ADDR A:0x67880c08
y.create.l HWIO_BLSP1_BLSP_BAM_VMIDMT_S2VR3_ADDR A:0x67880c0c
y.create.l HWIO_BLSP1_BLSP_BAM_VMIDMT_S2VR4_ADDR A:0x67880c10
y.create.l HWIO_BLSP1_BLSP_BAM_VMIDMT_S2VR5_ADDR A:0x67880c14
y.create.l HWIO_BLSP1_BLSP_BAM_VMIDMT_S2VR6_ADDR A:0x67880c18
y.create.l HWIO_BLSP1_BLSP_BAM_VMIDMT_S2VR7_ADDR A:0x67880c1c
y.create.l HWIO_BLSP1_BLSP_BAM_VMIDMT_S2VR8_ADDR A:0x67880c20
y.create.l HWIO_BLSP1_BLSP_BAM_VMIDMT_S2VR9_ADDR A:0x67880c24
y.create.l HWIO_BLSP1_BLSP_BAM_VMIDMT_AS2VR0_ADDR A:0x67880e00
y.create.l HWIO_BLSP1_BLSP_BAM_VMIDMT_AS2VR1_ADDR A:0x67880e04
y.create.l HWIO_BLSP1_BLSP_BAM_VMIDMT_AS2VR2_ADDR A:0x67880e08
y.create.l HWIO_BLSP1_BLSP_BAM_VMIDMT_AS2VR3_ADDR A:0x67880e0c
y.create.l HWIO_BLSP1_BLSP_BAM_VMIDMT_AS2VR4_ADDR A:0x67880e10
y.create.l HWIO_BLSP1_BLSP_BAM_VMIDMT_AS2VR5_ADDR A:0x67880e14
y.create.l HWIO_BLSP1_BLSP_BAM_VMIDMT_AS2VR6_ADDR A:0x67880e18
y.create.l HWIO_BLSP1_BLSP_BAM_VMIDMT_AS2VR7_ADDR A:0x67880e1c
y.create.l HWIO_BLSP1_BLSP_BAM_VMIDMT_AS2VR8_ADDR A:0x67880e20
y.create.l HWIO_BLSP1_BLSP_BAM_VMIDMT_AS2VR9_ADDR A:0x67880e24
y.create.l HWIO_BLSP1_BLSP_BAM_VMIDMT_SMR0_ADDR A:0x67880800
y.create.l HWIO_BLSP1_BLSP_BAM_VMIDMT_SMR1_ADDR A:0x67880804
y.create.l HWIO_BLSP1_BLSP_BAM_VMIDMT_SMR2_ADDR A:0x67880808
y.create.l HWIO_BLSP1_BLSP_BAM_VMIDMT_SMR3_ADDR A:0x6788080c
y.create.l HWIO_BLSP1_BLSP_BAM_VMIDMT_SMR4_ADDR A:0x67880810
y.create.l HWIO_BLSP1_BLSP_BAM_VMIDMT_SMR5_ADDR A:0x67880814
y.create.l HWIO_BLSP1_BLSP_BAM_VMIDMT_SMR6_ADDR A:0x67880818
y.create.l HWIO_BLSP1_BLSP_BAM_VMIDMT_SMR7_ADDR A:0x6788081c
y.create.l HWIO_BLSP1_BLSP_BAM_VMIDMT_SMR8_ADDR A:0x67880820
y.create.l HWIO_BLSP1_BLSP_BAM_VMIDMT_SMR9_ADDR A:0x67880824
y.create.l HWIO_BLSP1_BLSP_UART0_UART_DM_MR1_ADDR A:0x678af000
y.create.l HWIO_BLSP1_BLSP_UART0_UART_DM_MR2_ADDR A:0x678af004
y.create.l HWIO_BLSP1_BLSP_UART0_UART_DM_CSR_SR_DEPRECATED_ADDR A:0x678af008
y.create.l HWIO_BLSP1_BLSP_UART0_UART_DM_CR_MISR_DEPRECATED_ADDR A:0x678af010
y.create.l HWIO_BLSP1_BLSP_UART0_UART_DM_IMR_ISR_DEPRECATED_ADDR A:0x678af014
y.create.l HWIO_BLSP1_BLSP_UART0_UART_DM_IPR_ADDR A:0x678af018
y.create.l HWIO_BLSP1_BLSP_UART0_UART_DM_TFWR_ADDR A:0x678af01c
y.create.l HWIO_BLSP1_BLSP_UART0_UART_DM_RFWR_ADDR A:0x678af020
y.create.l HWIO_BLSP1_BLSP_UART0_UART_DM_HCR_ADDR A:0x678af024
y.create.l HWIO_BLSP1_BLSP_UART0_UART_DM_DMRX_ADDR A:0x678af034
y.create.l HWIO_BLSP1_BLSP_UART0_UART_DM_IRDA_RX_TOTAL_SNAP_DEPRECATED_ADDR A:0x678af038
y.create.l HWIO_BLSP1_BLSP_UART0_UART_DM_DMEN_ADDR A:0x678af03c
y.create.l HWIO_BLSP1_BLSP_UART0_UART_DM_NO_CHARS_FOR_TX_ADDR A:0x678af040
y.create.l HWIO_BLSP1_BLSP_UART0_UART_DM_BADR_ADDR A:0x678af044
y.create.l HWIO_BLSP1_BLSP_UART0_UART_DM_TESTSL_ADDR A:0x678af048
y.create.l HWIO_BLSP1_BLSP_UART0_UART_DM_TXFS_ADDR A:0x678af04c
y.create.l HWIO_BLSP1_BLSP_UART0_UART_DM_RXFS_ADDR A:0x678af050
y.create.l HWIO_BLSP1_BLSP_UART0_UART_DM_MISR_MODE_ADDR A:0x678af060
y.create.l HWIO_BLSP1_BLSP_UART0_UART_DM_MISR_RESET_ADDR A:0x678af064
y.create.l HWIO_BLSP1_BLSP_UART0_UART_DM_MISR_EXPORT_ADDR A:0x678af068
y.create.l HWIO_BLSP1_BLSP_UART0_UART_DM_MISR_VAL_ADDR A:0x678af06c
y.create.l HWIO_BLSP1_BLSP_UART0_UART_DM_TF_RF_DEPRECATED_ADDR A:0x678af070
y.create.l HWIO_BLSP1_BLSP_UART0_UART_DM_TF_RF_2_DEPRECATED_ADDR A:0x678af074
y.create.l HWIO_BLSP1_BLSP_UART0_UART_DM_TF_RF_3_DEPRECATED_ADDR A:0x678af078
y.create.l HWIO_BLSP1_BLSP_UART0_UART_DM_TF_RF_4_DEPRECATED_ADDR A:0x678af07c
y.create.l HWIO_BLSP1_BLSP_UART0_UART_DM_SIM_CFG_ADDR A:0x678af080
y.create.l HWIO_BLSP1_BLSP_UART0_UART_DM_TEST_WR_ADDR_ADDR A:0x678af084
y.create.l HWIO_BLSP1_BLSP_UART0_UART_DM_TEST_WR_DATA_ADDR A:0x678af088
y.create.l HWIO_BLSP1_BLSP_UART0_UART_DM_TEST_RD_ADDR_ADDR A:0x678af08c
y.create.l HWIO_BLSP1_BLSP_UART0_UART_DM_TEST_RD_DATA_ADDR A:0x678af090
y.create.l HWIO_BLSP1_BLSP_UART0_UART_DM_CSR_ADDR A:0x678af0a0
y.create.l HWIO_BLSP1_BLSP_UART0_UART_DM_SR_ADDR A:0x678af0a4
y.create.l HWIO_BLSP1_BLSP_UART0_UART_DM_CR_ADDR A:0x678af0a8
y.create.l HWIO_BLSP1_BLSP_UART0_UART_DM_MISR_ADDR A:0x678af0ac
y.create.l HWIO_BLSP1_BLSP_UART0_UART_DM_IMR_ADDR A:0x678af0b0
y.create.l HWIO_BLSP1_BLSP_UART0_UART_DM_ISR_ADDR A:0x678af0b4
y.create.l HWIO_BLSP1_BLSP_UART0_UART_DM_IRDA_ADDR A:0x678af0b8
y.create.l HWIO_BLSP1_BLSP_UART0_UART_DM_RX_TOTAL_SNAP_ADDR A:0x678af0bc
y.create.l HWIO_BLSP1_BLSP_UART0_UART_DM_WWT_TIMEOUT_ADDR A:0x678af0c0
y.create.l HWIO_BLSP1_BLSP_UART0_UART_DM_CLK_CTRL_ADDR A:0x678af0c4
y.create.l HWIO_BLSP1_BLSP_UART0_UART_DM_BCR_ADDR A:0x678af0c8
y.create.l HWIO_BLSP1_BLSP_UART0_UART_DM_RX_TRANS_CTRL_ADDR A:0x678af0cc
y.create.l HWIO_BLSP1_BLSP_UART0_UART_DM_DMRX_DBG_ADDR A:0x678af0d0
y.create.l HWIO_BLSP1_BLSP_UART0_UART_DM_FSM_STATUS_ADDR A:0x678af0d4
y.create.l HWIO_BLSP1_BLSP_UART0_UART_DM_HW_VERSION_ADDR A:0x678af0d8
y.create.l HWIO_BLSP1_BLSP_UART0_UART_DM_GENERICS_ADDR A:0x678af0dc
y.create.l HWIO_BLSP1_BLSP_UART0_UART_DM_TF_ADDR A:0x678af100
y.create.l HWIO_BLSP1_BLSP_UART0_UART_DM_TF_2_ADDR A:0x678af104
y.create.l HWIO_BLSP1_BLSP_UART0_UART_DM_TF_3_ADDR A:0x678af108
y.create.l HWIO_BLSP1_BLSP_UART0_UART_DM_TF_4_ADDR A:0x678af10c
y.create.l HWIO_BLSP1_BLSP_UART0_UART_DM_TF_5_ADDR A:0x678af110
y.create.l HWIO_BLSP1_BLSP_UART0_UART_DM_TF_6_ADDR A:0x678af114
y.create.l HWIO_BLSP1_BLSP_UART0_UART_DM_TF_7_ADDR A:0x678af118
y.create.l HWIO_BLSP1_BLSP_UART0_UART_DM_TF_8_ADDR A:0x678af11c
y.create.l HWIO_BLSP1_BLSP_UART0_UART_DM_TF_9_ADDR A:0x678af120
y.create.l HWIO_BLSP1_BLSP_UART0_UART_DM_TF_10_ADDR A:0x678af124
y.create.l HWIO_BLSP1_BLSP_UART0_UART_DM_TF_11_ADDR A:0x678af128
y.create.l HWIO_BLSP1_BLSP_UART0_UART_DM_TF_12_ADDR A:0x678af12c
y.create.l HWIO_BLSP1_BLSP_UART0_UART_DM_TF_13_ADDR A:0x678af130
y.create.l HWIO_BLSP1_BLSP_UART0_UART_DM_TF_14_ADDR A:0x678af134
y.create.l HWIO_BLSP1_BLSP_UART0_UART_DM_TF_15_ADDR A:0x678af138
y.create.l HWIO_BLSP1_BLSP_UART0_UART_DM_TF_16_ADDR A:0x678af13c
y.create.l HWIO_BLSP1_BLSP_UART0_UART_DM_RF_ADDR A:0x678af140
y.create.l HWIO_BLSP1_BLSP_UART0_UART_DM_RF_2_ADDR A:0x678af144
y.create.l HWIO_BLSP1_BLSP_UART0_UART_DM_RF_3_ADDR A:0x678af148
y.create.l HWIO_BLSP1_BLSP_UART0_UART_DM_RF_4_ADDR A:0x678af14c
y.create.l HWIO_BLSP1_BLSP_UART0_UART_DM_RF_5_ADDR A:0x678af150
y.create.l HWIO_BLSP1_BLSP_UART0_UART_DM_RF_6_ADDR A:0x678af154
y.create.l HWIO_BLSP1_BLSP_UART0_UART_DM_RF_7_ADDR A:0x678af158
y.create.l HWIO_BLSP1_BLSP_UART0_UART_DM_RF_8_ADDR A:0x678af15c
y.create.l HWIO_BLSP1_BLSP_UART0_UART_DM_RF_9_ADDR A:0x678af160
y.create.l HWIO_BLSP1_BLSP_UART0_UART_DM_RF_10_ADDR A:0x678af164
y.create.l HWIO_BLSP1_BLSP_UART0_UART_DM_RF_11_ADDR A:0x678af168
y.create.l HWIO_BLSP1_BLSP_UART0_UART_DM_RF_12_ADDR A:0x678af16c
y.create.l HWIO_BLSP1_BLSP_UART0_UART_DM_RF_13_ADDR A:0x678af170
y.create.l HWIO_BLSP1_BLSP_UART0_UART_DM_RF_14_ADDR A:0x678af174
y.create.l HWIO_BLSP1_BLSP_UART0_UART_DM_RF_15_ADDR A:0x678af178
y.create.l HWIO_BLSP1_BLSP_UART0_UART_DM_RF_16_ADDR A:0x678af17c
y.create.l HWIO_BLSP1_BLSP_UART0_UART_DM_UIM_CFG_ADDR A:0x678af180
y.create.l HWIO_BLSP1_BLSP_UART0_UART_DM_UIM_CMD_ADDR A:0x678af184
y.create.l HWIO_BLSP1_BLSP_UART0_UART_DM_UIM_IO_STATUS_ADDR A:0x678af188
y.create.l HWIO_BLSP1_BLSP_UART0_UART_DM_UIM_IRQ_ISR_ADDR A:0x678af18c
y.create.l HWIO_BLSP1_BLSP_UART0_UART_DM_UIM_IRQ_MISR_ADDR A:0x678af190
y.create.l HWIO_BLSP1_BLSP_UART0_UART_DM_UIM_IRQ_CLR_ADDR A:0x678af194
y.create.l HWIO_BLSP1_BLSP_UART0_UART_DM_UIM_IRQ_IMR_ADDR A:0x678af198
y.create.l HWIO_BLSP1_BLSP_UART0_UART_DM_UIM_IRQ_IMR_SET_ADDR A:0x678af19c
y.create.l HWIO_BLSP1_BLSP_UART0_UART_DM_UIM_IRQ_IMR_CLR_ADDR A:0x678af1a0
y.create.l HWIO_BLSP1_BLSP_UART1_UART_DM_MR1_ADDR A:0x678b0000
y.create.l HWIO_BLSP1_BLSP_UART1_UART_DM_MR2_ADDR A:0x678b0004
y.create.l HWIO_BLSP1_BLSP_UART1_UART_DM_CSR_SR_DEPRECATED_ADDR A:0x678b0008
y.create.l HWIO_BLSP1_BLSP_UART1_UART_DM_CR_MISR_DEPRECATED_ADDR A:0x678b0010
y.create.l HWIO_BLSP1_BLSP_UART1_UART_DM_IMR_ISR_DEPRECATED_ADDR A:0x678b0014
y.create.l HWIO_BLSP1_BLSP_UART1_UART_DM_IPR_ADDR A:0x678b0018
y.create.l HWIO_BLSP1_BLSP_UART1_UART_DM_TFWR_ADDR A:0x678b001c
y.create.l HWIO_BLSP1_BLSP_UART1_UART_DM_RFWR_ADDR A:0x678b0020
y.create.l HWIO_BLSP1_BLSP_UART1_UART_DM_HCR_ADDR A:0x678b0024
y.create.l HWIO_BLSP1_BLSP_UART1_UART_DM_DMRX_ADDR A:0x678b0034
y.create.l HWIO_BLSP1_BLSP_UART1_UART_DM_IRDA_RX_TOTAL_SNAP_DEPRECATED_ADDR A:0x678b0038
y.create.l HWIO_BLSP1_BLSP_UART1_UART_DM_DMEN_ADDR A:0x678b003c
y.create.l HWIO_BLSP1_BLSP_UART1_UART_DM_NO_CHARS_FOR_TX_ADDR A:0x678b0040
y.create.l HWIO_BLSP1_BLSP_UART1_UART_DM_BADR_ADDR A:0x678b0044
y.create.l HWIO_BLSP1_BLSP_UART1_UART_DM_TESTSL_ADDR A:0x678b0048
y.create.l HWIO_BLSP1_BLSP_UART1_UART_DM_TXFS_ADDR A:0x678b004c
y.create.l HWIO_BLSP1_BLSP_UART1_UART_DM_RXFS_ADDR A:0x678b0050
y.create.l HWIO_BLSP1_BLSP_UART1_UART_DM_MISR_MODE_ADDR A:0x678b0060
y.create.l HWIO_BLSP1_BLSP_UART1_UART_DM_MISR_RESET_ADDR A:0x678b0064
y.create.l HWIO_BLSP1_BLSP_UART1_UART_DM_MISR_EXPORT_ADDR A:0x678b0068
y.create.l HWIO_BLSP1_BLSP_UART1_UART_DM_MISR_VAL_ADDR A:0x678b006c
y.create.l HWIO_BLSP1_BLSP_UART1_UART_DM_TF_RF_DEPRECATED_ADDR A:0x678b0070
y.create.l HWIO_BLSP1_BLSP_UART1_UART_DM_TF_RF_2_DEPRECATED_ADDR A:0x678b0074
y.create.l HWIO_BLSP1_BLSP_UART1_UART_DM_TF_RF_3_DEPRECATED_ADDR A:0x678b0078
y.create.l HWIO_BLSP1_BLSP_UART1_UART_DM_TF_RF_4_DEPRECATED_ADDR A:0x678b007c
y.create.l HWIO_BLSP1_BLSP_UART1_UART_DM_SIM_CFG_ADDR A:0x678b0080
y.create.l HWIO_BLSP1_BLSP_UART1_UART_DM_TEST_WR_ADDR_ADDR A:0x678b0084
y.create.l HWIO_BLSP1_BLSP_UART1_UART_DM_TEST_WR_DATA_ADDR A:0x678b0088
y.create.l HWIO_BLSP1_BLSP_UART1_UART_DM_TEST_RD_ADDR_ADDR A:0x678b008c
y.create.l HWIO_BLSP1_BLSP_UART1_UART_DM_TEST_RD_DATA_ADDR A:0x678b0090
y.create.l HWIO_BLSP1_BLSP_UART1_UART_DM_CSR_ADDR A:0x678b00a0
y.create.l HWIO_BLSP1_BLSP_UART1_UART_DM_SR_ADDR A:0x678b00a4
y.create.l HWIO_BLSP1_BLSP_UART1_UART_DM_CR_ADDR A:0x678b00a8
y.create.l HWIO_BLSP1_BLSP_UART1_UART_DM_MISR_ADDR A:0x678b00ac
y.create.l HWIO_BLSP1_BLSP_UART1_UART_DM_IMR_ADDR A:0x678b00b0
y.create.l HWIO_BLSP1_BLSP_UART1_UART_DM_ISR_ADDR A:0x678b00b4
y.create.l HWIO_BLSP1_BLSP_UART1_UART_DM_IRDA_ADDR A:0x678b00b8
y.create.l HWIO_BLSP1_BLSP_UART1_UART_DM_RX_TOTAL_SNAP_ADDR A:0x678b00bc
y.create.l HWIO_BLSP1_BLSP_UART1_UART_DM_WWT_TIMEOUT_ADDR A:0x678b00c0
y.create.l HWIO_BLSP1_BLSP_UART1_UART_DM_CLK_CTRL_ADDR A:0x678b00c4
y.create.l HWIO_BLSP1_BLSP_UART1_UART_DM_BCR_ADDR A:0x678b00c8
y.create.l HWIO_BLSP1_BLSP_UART1_UART_DM_RX_TRANS_CTRL_ADDR A:0x678b00cc
y.create.l HWIO_BLSP1_BLSP_UART1_UART_DM_DMRX_DBG_ADDR A:0x678b00d0
y.create.l HWIO_BLSP1_BLSP_UART1_UART_DM_FSM_STATUS_ADDR A:0x678b00d4
y.create.l HWIO_BLSP1_BLSP_UART1_UART_DM_HW_VERSION_ADDR A:0x678b00d8
y.create.l HWIO_BLSP1_BLSP_UART1_UART_DM_GENERICS_ADDR A:0x678b00dc
y.create.l HWIO_BLSP1_BLSP_UART1_UART_DM_TF_ADDR A:0x678b0100
y.create.l HWIO_BLSP1_BLSP_UART1_UART_DM_TF_2_ADDR A:0x678b0104
y.create.l HWIO_BLSP1_BLSP_UART1_UART_DM_TF_3_ADDR A:0x678b0108
y.create.l HWIO_BLSP1_BLSP_UART1_UART_DM_TF_4_ADDR A:0x678b010c
y.create.l HWIO_BLSP1_BLSP_UART1_UART_DM_TF_5_ADDR A:0x678b0110
y.create.l HWIO_BLSP1_BLSP_UART1_UART_DM_TF_6_ADDR A:0x678b0114
y.create.l HWIO_BLSP1_BLSP_UART1_UART_DM_TF_7_ADDR A:0x678b0118
y.create.l HWIO_BLSP1_BLSP_UART1_UART_DM_TF_8_ADDR A:0x678b011c
y.create.l HWIO_BLSP1_BLSP_UART1_UART_DM_TF_9_ADDR A:0x678b0120
y.create.l HWIO_BLSP1_BLSP_UART1_UART_DM_TF_10_ADDR A:0x678b0124
y.create.l HWIO_BLSP1_BLSP_UART1_UART_DM_TF_11_ADDR A:0x678b0128
y.create.l HWIO_BLSP1_BLSP_UART1_UART_DM_TF_12_ADDR A:0x678b012c
y.create.l HWIO_BLSP1_BLSP_UART1_UART_DM_TF_13_ADDR A:0x678b0130
y.create.l HWIO_BLSP1_BLSP_UART1_UART_DM_TF_14_ADDR A:0x678b0134
y.create.l HWIO_BLSP1_BLSP_UART1_UART_DM_TF_15_ADDR A:0x678b0138
y.create.l HWIO_BLSP1_BLSP_UART1_UART_DM_TF_16_ADDR A:0x678b013c
y.create.l HWIO_BLSP1_BLSP_UART1_UART_DM_RF_ADDR A:0x678b0140
y.create.l HWIO_BLSP1_BLSP_UART1_UART_DM_RF_2_ADDR A:0x678b0144
y.create.l HWIO_BLSP1_BLSP_UART1_UART_DM_RF_3_ADDR A:0x678b0148
y.create.l HWIO_BLSP1_BLSP_UART1_UART_DM_RF_4_ADDR A:0x678b014c
y.create.l HWIO_BLSP1_BLSP_UART1_UART_DM_RF_5_ADDR A:0x678b0150
y.create.l HWIO_BLSP1_BLSP_UART1_UART_DM_RF_6_ADDR A:0x678b0154
y.create.l HWIO_BLSP1_BLSP_UART1_UART_DM_RF_7_ADDR A:0x678b0158
y.create.l HWIO_BLSP1_BLSP_UART1_UART_DM_RF_8_ADDR A:0x678b015c
y.create.l HWIO_BLSP1_BLSP_UART1_UART_DM_RF_9_ADDR A:0x678b0160
y.create.l HWIO_BLSP1_BLSP_UART1_UART_DM_RF_10_ADDR A:0x678b0164
y.create.l HWIO_BLSP1_BLSP_UART1_UART_DM_RF_11_ADDR A:0x678b0168
y.create.l HWIO_BLSP1_BLSP_UART1_UART_DM_RF_12_ADDR A:0x678b016c
y.create.l HWIO_BLSP1_BLSP_UART1_UART_DM_RF_13_ADDR A:0x678b0170
y.create.l HWIO_BLSP1_BLSP_UART1_UART_DM_RF_14_ADDR A:0x678b0174
y.create.l HWIO_BLSP1_BLSP_UART1_UART_DM_RF_15_ADDR A:0x678b0178
y.create.l HWIO_BLSP1_BLSP_UART1_UART_DM_RF_16_ADDR A:0x678b017c
y.create.l HWIO_BLSP1_BLSP_UART1_UART_DM_UIM_CFG_ADDR A:0x678b0180
y.create.l HWIO_BLSP1_BLSP_UART1_UART_DM_UIM_CMD_ADDR A:0x678b0184
y.create.l HWIO_BLSP1_BLSP_UART1_UART_DM_UIM_IO_STATUS_ADDR A:0x678b0188
y.create.l HWIO_BLSP1_BLSP_UART1_UART_DM_UIM_IRQ_ISR_ADDR A:0x678b018c
y.create.l HWIO_BLSP1_BLSP_UART1_UART_DM_UIM_IRQ_MISR_ADDR A:0x678b0190
y.create.l HWIO_BLSP1_BLSP_UART1_UART_DM_UIM_IRQ_CLR_ADDR A:0x678b0194
y.create.l HWIO_BLSP1_BLSP_UART1_UART_DM_UIM_IRQ_IMR_ADDR A:0x678b0198
y.create.l HWIO_BLSP1_BLSP_UART1_UART_DM_UIM_IRQ_IMR_SET_ADDR A:0x678b019c
y.create.l HWIO_BLSP1_BLSP_UART1_UART_DM_UIM_IRQ_IMR_CLR_ADDR A:0x678b01a0
y.create.l HWIO_BLSP1_BLSP_QUP0_QUP_CONFIG_ADDR A:0x678b5000
y.create.l HWIO_BLSP1_BLSP_QUP0_QUP_STATE_ADDR A:0x678b5004
y.create.l HWIO_BLSP1_BLSP_QUP0_QUP_IO_MODES_ADDR A:0x678b5008
y.create.l HWIO_BLSP1_BLSP_QUP0_QUP_SW_RESET_ADDR A:0x678b500c
y.create.l HWIO_BLSP1_BLSP_QUP0_QUP_TRANSFER_CANCEL_ADDR A:0x678b5014
y.create.l HWIO_BLSP1_BLSP_QUP0_QUP_OPERATIONAL_ADDR A:0x678b5018
y.create.l HWIO_BLSP1_BLSP_QUP0_QUP_ERROR_FLAGS_ADDR A:0x678b501c
y.create.l HWIO_BLSP1_BLSP_QUP0_QUP_ERROR_FLAGS_EN_ADDR A:0x678b5020
y.create.l HWIO_BLSP1_BLSP_QUP0_QUP_TEST_CTRL_ADDR A:0x678b5024
y.create.l HWIO_BLSP1_BLSP_QUP0_QUP_OPERATIONAL_MASK_ADDR A:0x678b5028
y.create.l HWIO_BLSP1_BLSP_QUP0_QUP_HW_VERSION_ADDR A:0x678b5030
y.create.l HWIO_BLSP1_BLSP_QUP0_QUP_MX_OUTPUT_COUNT_ADDR A:0x678b5100
y.create.l HWIO_BLSP1_BLSP_QUP0_QUP_MX_OUTPUT_CNT_CURRENT_ADDR A:0x678b5104
y.create.l HWIO_BLSP1_BLSP_QUP0_QUP_OUTPUT_DEBUG_ADDR A:0x678b5108
y.create.l HWIO_BLSP1_BLSP_QUP0_QUP_OUTPUT_FIFO_WORD_CNT_ADDR A:0x678b510c
y.create.l HWIO_BLSP1_BLSP_QUP0_QUP_OUTPUT_FIFO0_ADDR A:0x678b5110
y.create.l HWIO_BLSP1_BLSP_QUP0_QUP_OUTPUT_FIFO1_ADDR A:0x678b5114
y.create.l HWIO_BLSP1_BLSP_QUP0_QUP_OUTPUT_FIFO2_ADDR A:0x678b5118
y.create.l HWIO_BLSP1_BLSP_QUP0_QUP_OUTPUT_FIFO3_ADDR A:0x678b511c
y.create.l HWIO_BLSP1_BLSP_QUP0_QUP_OUTPUT_FIFO4_ADDR A:0x678b5120
y.create.l HWIO_BLSP1_BLSP_QUP0_QUP_OUTPUT_FIFO5_ADDR A:0x678b5124
y.create.l HWIO_BLSP1_BLSP_QUP0_QUP_OUTPUT_FIFO6_ADDR A:0x678b5128
y.create.l HWIO_BLSP1_BLSP_QUP0_QUP_OUTPUT_FIFO7_ADDR A:0x678b512c
y.create.l HWIO_BLSP1_BLSP_QUP0_QUP_OUTPUT_FIFO8_ADDR A:0x678b5130
y.create.l HWIO_BLSP1_BLSP_QUP0_QUP_OUTPUT_FIFO9_ADDR A:0x678b5134
y.create.l HWIO_BLSP1_BLSP_QUP0_QUP_MX_WRITE_COUNT_ADDR A:0x678b5150
y.create.l HWIO_BLSP1_BLSP_QUP0_QUP_MX_WRITE_CNT_CURRENT_ADDR A:0x678b5154
y.create.l HWIO_BLSP1_BLSP_QUP0_QUP_MX_INPUT_COUNT_ADDR A:0x678b5200
y.create.l HWIO_BLSP1_BLSP_QUP0_QUP_MX_INPUT_CNT_CURRENT_ADDR A:0x678b5204
y.create.l HWIO_BLSP1_BLSP_QUP0_QUP_MX_READ_COUNT_ADDR A:0x678b5208
y.create.l HWIO_BLSP1_BLSP_QUP0_QUP_MX_READ_CNT_CURRENT_ADDR A:0x678b520c
y.create.l HWIO_BLSP1_BLSP_QUP0_QUP_INPUT_DEBUG_ADDR A:0x678b5210
y.create.l HWIO_BLSP1_BLSP_QUP0_QUP_INPUT_FIFO_WORD_CNT_ADDR A:0x678b5214
y.create.l HWIO_BLSP1_BLSP_QUP0_QUP_INPUT_FIFO0_ADDR A:0x678b5218
y.create.l HWIO_BLSP1_BLSP_QUP0_QUP_INPUT_FIFO1_ADDR A:0x678b521c
y.create.l HWIO_BLSP1_BLSP_QUP0_QUP_INPUT_FIFO2_ADDR A:0x678b5220
y.create.l HWIO_BLSP1_BLSP_QUP0_QUP_INPUT_FIFO3_ADDR A:0x678b5224
y.create.l HWIO_BLSP1_BLSP_QUP0_QUP_INPUT_FIFO4_ADDR A:0x678b5228
y.create.l HWIO_BLSP1_BLSP_QUP0_QUP_INPUT_FIFO5_ADDR A:0x678b522c
y.create.l HWIO_BLSP1_BLSP_QUP0_QUP_INPUT_FIFO6_ADDR A:0x678b5230
y.create.l HWIO_BLSP1_BLSP_QUP0_QUP_INPUT_FIFO7_ADDR A:0x678b5234
y.create.l HWIO_BLSP1_BLSP_QUP0_QUP_INPUT_FIFO8_ADDR A:0x678b5238
y.create.l HWIO_BLSP1_BLSP_QUP0_QUP_INPUT_FIFO9_ADDR A:0x678b523c
y.create.l HWIO_BLSP1_BLSP_QUP0_SPI_CONFIG_ADDR A:0x678b5300
y.create.l HWIO_BLSP1_BLSP_QUP0_SPI_IO_CONTROL_ADDR A:0x678b5304
y.create.l HWIO_BLSP1_BLSP_QUP0_SPI_ERROR_FLAGS_ADDR A:0x678b5308
y.create.l HWIO_BLSP1_BLSP_QUP0_SPI_ERROR_FLAGS_EN_ADDR A:0x678b530c
y.create.l HWIO_BLSP1_BLSP_QUP0_SPI_DEASSERT_WAIT_ADDR A:0x678b5310
y.create.l HWIO_BLSP1_BLSP_QUP0_SPI_MASTER_LOCAL_ID_ADDR A:0x678b5314
y.create.l HWIO_BLSP1_BLSP_QUP0_SPI_MASTER_COMMAND_ADDR A:0x678b5318
y.create.l HWIO_BLSP1_BLSP_QUP0_SPI_MASTER_STATUS_ADDR A:0x678b531c
y.create.l HWIO_BLSP1_BLSP_QUP0_SPI_CHAR_CFG_ADDR A:0x678b5320
y.create.l HWIO_BLSP1_BLSP_QUP0_SPI_CHAR_DATA_SPI_CS_ADDR A:0x678b5324
y.create.l HWIO_BLSP1_BLSP_QUP0_SPI_CHAR_DATA_SPI_MOSI_ADDR A:0x678b5328
y.create.l HWIO_BLSP1_BLSP_QUP0_SPI_CHAR_DATA_SPI_MISO_ADDR A:0x678b532c
y.create.l HWIO_BLSP1_BLSP_QUP0_I2C_MASTER_CLK_CTL_ADDR A:0x678b5400
y.create.l HWIO_BLSP1_BLSP_QUP0_I2C_MASTER_STATUS_ADDR A:0x678b5404
y.create.l HWIO_BLSP1_BLSP_QUP0_I2C_MASTER_CONFIG_ADDR A:0x678b5408
y.create.l HWIO_BLSP1_BLSP_QUP0_I2C_MASTER_BUS_CLEAR_ADDR A:0x678b540c
y.create.l HWIO_BLSP1_BLSP_QUP0_I2C_MASTER_LOCAL_ID_ADDR A:0x678b5410
y.create.l HWIO_BLSP1_BLSP_QUP0_I2C_MASTER_COMMAND_ADDR A:0x678b5414
y.create.l HWIO_BLSP1_BLSP_QUP1_QUP_CONFIG_ADDR A:0x678b6000
y.create.l HWIO_BLSP1_BLSP_QUP1_QUP_STATE_ADDR A:0x678b6004
y.create.l HWIO_BLSP1_BLSP_QUP1_QUP_IO_MODES_ADDR A:0x678b6008
y.create.l HWIO_BLSP1_BLSP_QUP1_QUP_SW_RESET_ADDR A:0x678b600c
y.create.l HWIO_BLSP1_BLSP_QUP1_QUP_TRANSFER_CANCEL_ADDR A:0x678b6014
y.create.l HWIO_BLSP1_BLSP_QUP1_QUP_OPERATIONAL_ADDR A:0x678b6018
y.create.l HWIO_BLSP1_BLSP_QUP1_QUP_ERROR_FLAGS_ADDR A:0x678b601c
y.create.l HWIO_BLSP1_BLSP_QUP1_QUP_ERROR_FLAGS_EN_ADDR A:0x678b6020
y.create.l HWIO_BLSP1_BLSP_QUP1_QUP_TEST_CTRL_ADDR A:0x678b6024
y.create.l HWIO_BLSP1_BLSP_QUP1_QUP_OPERATIONAL_MASK_ADDR A:0x678b6028
y.create.l HWIO_BLSP1_BLSP_QUP1_QUP_HW_VERSION_ADDR A:0x678b6030
y.create.l HWIO_BLSP1_BLSP_QUP1_QUP_MX_OUTPUT_COUNT_ADDR A:0x678b6100
y.create.l HWIO_BLSP1_BLSP_QUP1_QUP_MX_OUTPUT_CNT_CURRENT_ADDR A:0x678b6104
y.create.l HWIO_BLSP1_BLSP_QUP1_QUP_OUTPUT_DEBUG_ADDR A:0x678b6108
y.create.l HWIO_BLSP1_BLSP_QUP1_QUP_OUTPUT_FIFO_WORD_CNT_ADDR A:0x678b610c
y.create.l HWIO_BLSP1_BLSP_QUP1_QUP_OUTPUT_FIFO0_ADDR A:0x678b6110
y.create.l HWIO_BLSP1_BLSP_QUP1_QUP_OUTPUT_FIFO1_ADDR A:0x678b6114
y.create.l HWIO_BLSP1_BLSP_QUP1_QUP_OUTPUT_FIFO2_ADDR A:0x678b6118
y.create.l HWIO_BLSP1_BLSP_QUP1_QUP_OUTPUT_FIFO3_ADDR A:0x678b611c
y.create.l HWIO_BLSP1_BLSP_QUP1_QUP_OUTPUT_FIFO4_ADDR A:0x678b6120
y.create.l HWIO_BLSP1_BLSP_QUP1_QUP_OUTPUT_FIFO5_ADDR A:0x678b6124
y.create.l HWIO_BLSP1_BLSP_QUP1_QUP_OUTPUT_FIFO6_ADDR A:0x678b6128
y.create.l HWIO_BLSP1_BLSP_QUP1_QUP_OUTPUT_FIFO7_ADDR A:0x678b612c
y.create.l HWIO_BLSP1_BLSP_QUP1_QUP_OUTPUT_FIFO8_ADDR A:0x678b6130
y.create.l HWIO_BLSP1_BLSP_QUP1_QUP_OUTPUT_FIFO9_ADDR A:0x678b6134
y.create.l HWIO_BLSP1_BLSP_QUP1_QUP_MX_WRITE_COUNT_ADDR A:0x678b6150
y.create.l HWIO_BLSP1_BLSP_QUP1_QUP_MX_WRITE_CNT_CURRENT_ADDR A:0x678b6154
y.create.l HWIO_BLSP1_BLSP_QUP1_QUP_MX_INPUT_COUNT_ADDR A:0x678b6200
y.create.l HWIO_BLSP1_BLSP_QUP1_QUP_MX_INPUT_CNT_CURRENT_ADDR A:0x678b6204
y.create.l HWIO_BLSP1_BLSP_QUP1_QUP_MX_READ_COUNT_ADDR A:0x678b6208
y.create.l HWIO_BLSP1_BLSP_QUP1_QUP_MX_READ_CNT_CURRENT_ADDR A:0x678b620c
y.create.l HWIO_BLSP1_BLSP_QUP1_QUP_INPUT_DEBUG_ADDR A:0x678b6210
y.create.l HWIO_BLSP1_BLSP_QUP1_QUP_INPUT_FIFO_WORD_CNT_ADDR A:0x678b6214
y.create.l HWIO_BLSP1_BLSP_QUP1_QUP_INPUT_FIFO0_ADDR A:0x678b6218
y.create.l HWIO_BLSP1_BLSP_QUP1_QUP_INPUT_FIFO1_ADDR A:0x678b621c
y.create.l HWIO_BLSP1_BLSP_QUP1_QUP_INPUT_FIFO2_ADDR A:0x678b6220
y.create.l HWIO_BLSP1_BLSP_QUP1_QUP_INPUT_FIFO3_ADDR A:0x678b6224
y.create.l HWIO_BLSP1_BLSP_QUP1_QUP_INPUT_FIFO4_ADDR A:0x678b6228
y.create.l HWIO_BLSP1_BLSP_QUP1_QUP_INPUT_FIFO5_ADDR A:0x678b622c
y.create.l HWIO_BLSP1_BLSP_QUP1_QUP_INPUT_FIFO6_ADDR A:0x678b6230
y.create.l HWIO_BLSP1_BLSP_QUP1_QUP_INPUT_FIFO7_ADDR A:0x678b6234
y.create.l HWIO_BLSP1_BLSP_QUP1_QUP_INPUT_FIFO8_ADDR A:0x678b6238
y.create.l HWIO_BLSP1_BLSP_QUP1_QUP_INPUT_FIFO9_ADDR A:0x678b623c
y.create.l HWIO_BLSP1_BLSP_QUP1_SPI_CONFIG_ADDR A:0x678b6300
y.create.l HWIO_BLSP1_BLSP_QUP1_SPI_IO_CONTROL_ADDR A:0x678b6304
y.create.l HWIO_BLSP1_BLSP_QUP1_SPI_ERROR_FLAGS_ADDR A:0x678b6308
y.create.l HWIO_BLSP1_BLSP_QUP1_SPI_ERROR_FLAGS_EN_ADDR A:0x678b630c
y.create.l HWIO_BLSP1_BLSP_QUP1_SPI_DEASSERT_WAIT_ADDR A:0x678b6310
y.create.l HWIO_BLSP1_BLSP_QUP1_SPI_MASTER_LOCAL_ID_ADDR A:0x678b6314
y.create.l HWIO_BLSP1_BLSP_QUP1_SPI_MASTER_COMMAND_ADDR A:0x678b6318
y.create.l HWIO_BLSP1_BLSP_QUP1_SPI_MASTER_STATUS_ADDR A:0x678b631c
y.create.l HWIO_BLSP1_BLSP_QUP1_SPI_CHAR_CFG_ADDR A:0x678b6320
y.create.l HWIO_BLSP1_BLSP_QUP1_SPI_CHAR_DATA_SPI_CS_ADDR A:0x678b6324
y.create.l HWIO_BLSP1_BLSP_QUP1_SPI_CHAR_DATA_SPI_MOSI_ADDR A:0x678b6328
y.create.l HWIO_BLSP1_BLSP_QUP1_SPI_CHAR_DATA_SPI_MISO_ADDR A:0x678b632c
y.create.l HWIO_BLSP1_BLSP_QUP1_I2C_MASTER_CLK_CTL_ADDR A:0x678b6400
y.create.l HWIO_BLSP1_BLSP_QUP1_I2C_MASTER_STATUS_ADDR A:0x678b6404
y.create.l HWIO_BLSP1_BLSP_QUP1_I2C_MASTER_CONFIG_ADDR A:0x678b6408
y.create.l HWIO_BLSP1_BLSP_QUP1_I2C_MASTER_BUS_CLEAR_ADDR A:0x678b640c
y.create.l HWIO_BLSP1_BLSP_QUP1_I2C_MASTER_LOCAL_ID_ADDR A:0x678b6410
y.create.l HWIO_BLSP1_BLSP_QUP1_I2C_MASTER_COMMAND_ADDR A:0x678b6414
y.create.l HWIO_BLSP1_BLSP_QUP2_QUP_CONFIG_ADDR A:0x678b7000
y.create.l HWIO_BLSP1_BLSP_QUP2_QUP_STATE_ADDR A:0x678b7004
y.create.l HWIO_BLSP1_BLSP_QUP2_QUP_IO_MODES_ADDR A:0x678b7008
y.create.l HWIO_BLSP1_BLSP_QUP2_QUP_SW_RESET_ADDR A:0x678b700c
y.create.l HWIO_BLSP1_BLSP_QUP2_QUP_TRANSFER_CANCEL_ADDR A:0x678b7014
y.create.l HWIO_BLSP1_BLSP_QUP2_QUP_OPERATIONAL_ADDR A:0x678b7018
y.create.l HWIO_BLSP1_BLSP_QUP2_QUP_ERROR_FLAGS_ADDR A:0x678b701c
y.create.l HWIO_BLSP1_BLSP_QUP2_QUP_ERROR_FLAGS_EN_ADDR A:0x678b7020
y.create.l HWIO_BLSP1_BLSP_QUP2_QUP_TEST_CTRL_ADDR A:0x678b7024
y.create.l HWIO_BLSP1_BLSP_QUP2_QUP_OPERATIONAL_MASK_ADDR A:0x678b7028
y.create.l HWIO_BLSP1_BLSP_QUP2_QUP_HW_VERSION_ADDR A:0x678b7030
y.create.l HWIO_BLSP1_BLSP_QUP2_QUP_MX_OUTPUT_COUNT_ADDR A:0x678b7100
y.create.l HWIO_BLSP1_BLSP_QUP2_QUP_MX_OUTPUT_CNT_CURRENT_ADDR A:0x678b7104
y.create.l HWIO_BLSP1_BLSP_QUP2_QUP_OUTPUT_DEBUG_ADDR A:0x678b7108
y.create.l HWIO_BLSP1_BLSP_QUP2_QUP_OUTPUT_FIFO_WORD_CNT_ADDR A:0x678b710c
y.create.l HWIO_BLSP1_BLSP_QUP2_QUP_OUTPUT_FIFO0_ADDR A:0x678b7110
y.create.l HWIO_BLSP1_BLSP_QUP2_QUP_OUTPUT_FIFO1_ADDR A:0x678b7114
y.create.l HWIO_BLSP1_BLSP_QUP2_QUP_OUTPUT_FIFO2_ADDR A:0x678b7118
y.create.l HWIO_BLSP1_BLSP_QUP2_QUP_OUTPUT_FIFO3_ADDR A:0x678b711c
y.create.l HWIO_BLSP1_BLSP_QUP2_QUP_OUTPUT_FIFO4_ADDR A:0x678b7120
y.create.l HWIO_BLSP1_BLSP_QUP2_QUP_OUTPUT_FIFO5_ADDR A:0x678b7124
y.create.l HWIO_BLSP1_BLSP_QUP2_QUP_OUTPUT_FIFO6_ADDR A:0x678b7128
y.create.l HWIO_BLSP1_BLSP_QUP2_QUP_OUTPUT_FIFO7_ADDR A:0x678b712c
y.create.l HWIO_BLSP1_BLSP_QUP2_QUP_OUTPUT_FIFO8_ADDR A:0x678b7130
y.create.l HWIO_BLSP1_BLSP_QUP2_QUP_OUTPUT_FIFO9_ADDR A:0x678b7134
y.create.l HWIO_BLSP1_BLSP_QUP2_QUP_MX_WRITE_COUNT_ADDR A:0x678b7150
y.create.l HWIO_BLSP1_BLSP_QUP2_QUP_MX_WRITE_CNT_CURRENT_ADDR A:0x678b7154
y.create.l HWIO_BLSP1_BLSP_QUP2_QUP_MX_INPUT_COUNT_ADDR A:0x678b7200
y.create.l HWIO_BLSP1_BLSP_QUP2_QUP_MX_INPUT_CNT_CURRENT_ADDR A:0x678b7204
y.create.l HWIO_BLSP1_BLSP_QUP2_QUP_MX_READ_COUNT_ADDR A:0x678b7208
y.create.l HWIO_BLSP1_BLSP_QUP2_QUP_MX_READ_CNT_CURRENT_ADDR A:0x678b720c
y.create.l HWIO_BLSP1_BLSP_QUP2_QUP_INPUT_DEBUG_ADDR A:0x678b7210
y.create.l HWIO_BLSP1_BLSP_QUP2_QUP_INPUT_FIFO_WORD_CNT_ADDR A:0x678b7214
y.create.l HWIO_BLSP1_BLSP_QUP2_QUP_INPUT_FIFO0_ADDR A:0x678b7218
y.create.l HWIO_BLSP1_BLSP_QUP2_QUP_INPUT_FIFO1_ADDR A:0x678b721c
y.create.l HWIO_BLSP1_BLSP_QUP2_QUP_INPUT_FIFO2_ADDR A:0x678b7220
y.create.l HWIO_BLSP1_BLSP_QUP2_QUP_INPUT_FIFO3_ADDR A:0x678b7224
y.create.l HWIO_BLSP1_BLSP_QUP2_QUP_INPUT_FIFO4_ADDR A:0x678b7228
y.create.l HWIO_BLSP1_BLSP_QUP2_QUP_INPUT_FIFO5_ADDR A:0x678b722c
y.create.l HWIO_BLSP1_BLSP_QUP2_QUP_INPUT_FIFO6_ADDR A:0x678b7230
y.create.l HWIO_BLSP1_BLSP_QUP2_QUP_INPUT_FIFO7_ADDR A:0x678b7234
y.create.l HWIO_BLSP1_BLSP_QUP2_QUP_INPUT_FIFO8_ADDR A:0x678b7238
y.create.l HWIO_BLSP1_BLSP_QUP2_QUP_INPUT_FIFO9_ADDR A:0x678b723c
y.create.l HWIO_BLSP1_BLSP_QUP2_SPI_CONFIG_ADDR A:0x678b7300
y.create.l HWIO_BLSP1_BLSP_QUP2_SPI_IO_CONTROL_ADDR A:0x678b7304
y.create.l HWIO_BLSP1_BLSP_QUP2_SPI_ERROR_FLAGS_ADDR A:0x678b7308
y.create.l HWIO_BLSP1_BLSP_QUP2_SPI_ERROR_FLAGS_EN_ADDR A:0x678b730c
y.create.l HWIO_BLSP1_BLSP_QUP2_SPI_DEASSERT_WAIT_ADDR A:0x678b7310
y.create.l HWIO_BLSP1_BLSP_QUP2_SPI_MASTER_LOCAL_ID_ADDR A:0x678b7314
y.create.l HWIO_BLSP1_BLSP_QUP2_SPI_MASTER_COMMAND_ADDR A:0x678b7318
y.create.l HWIO_BLSP1_BLSP_QUP2_SPI_MASTER_STATUS_ADDR A:0x678b731c
y.create.l HWIO_BLSP1_BLSP_QUP2_SPI_CHAR_CFG_ADDR A:0x678b7320
y.create.l HWIO_BLSP1_BLSP_QUP2_SPI_CHAR_DATA_SPI_CS_ADDR A:0x678b7324
y.create.l HWIO_BLSP1_BLSP_QUP2_SPI_CHAR_DATA_SPI_MOSI_ADDR A:0x678b7328
y.create.l HWIO_BLSP1_BLSP_QUP2_SPI_CHAR_DATA_SPI_MISO_ADDR A:0x678b732c
y.create.l HWIO_BLSP1_BLSP_QUP2_I2C_MASTER_CLK_CTL_ADDR A:0x678b7400
y.create.l HWIO_BLSP1_BLSP_QUP2_I2C_MASTER_STATUS_ADDR A:0x678b7404
y.create.l HWIO_BLSP1_BLSP_QUP2_I2C_MASTER_CONFIG_ADDR A:0x678b7408
y.create.l HWIO_BLSP1_BLSP_QUP2_I2C_MASTER_BUS_CLEAR_ADDR A:0x678b740c
y.create.l HWIO_BLSP1_BLSP_QUP2_I2C_MASTER_LOCAL_ID_ADDR A:0x678b7410
y.create.l HWIO_BLSP1_BLSP_QUP2_I2C_MASTER_COMMAND_ADDR A:0x678b7414
y.create.l HWIO_BLSP1_BLSP_QUP3_QUP_CONFIG_ADDR A:0x678b8000
y.create.l HWIO_BLSP1_BLSP_QUP3_QUP_STATE_ADDR A:0x678b8004
y.create.l HWIO_BLSP1_BLSP_QUP3_QUP_IO_MODES_ADDR A:0x678b8008
y.create.l HWIO_BLSP1_BLSP_QUP3_QUP_SW_RESET_ADDR A:0x678b800c
y.create.l HWIO_BLSP1_BLSP_QUP3_QUP_TRANSFER_CANCEL_ADDR A:0x678b8014
y.create.l HWIO_BLSP1_BLSP_QUP3_QUP_OPERATIONAL_ADDR A:0x678b8018
y.create.l HWIO_BLSP1_BLSP_QUP3_QUP_ERROR_FLAGS_ADDR A:0x678b801c
y.create.l HWIO_BLSP1_BLSP_QUP3_QUP_ERROR_FLAGS_EN_ADDR A:0x678b8020
y.create.l HWIO_BLSP1_BLSP_QUP3_QUP_TEST_CTRL_ADDR A:0x678b8024
y.create.l HWIO_BLSP1_BLSP_QUP3_QUP_OPERATIONAL_MASK_ADDR A:0x678b8028
y.create.l HWIO_BLSP1_BLSP_QUP3_QUP_HW_VERSION_ADDR A:0x678b8030
y.create.l HWIO_BLSP1_BLSP_QUP3_QUP_MX_OUTPUT_COUNT_ADDR A:0x678b8100
y.create.l HWIO_BLSP1_BLSP_QUP3_QUP_MX_OUTPUT_CNT_CURRENT_ADDR A:0x678b8104
y.create.l HWIO_BLSP1_BLSP_QUP3_QUP_OUTPUT_DEBUG_ADDR A:0x678b8108
y.create.l HWIO_BLSP1_BLSP_QUP3_QUP_OUTPUT_FIFO_WORD_CNT_ADDR A:0x678b810c
y.create.l HWIO_BLSP1_BLSP_QUP3_QUP_OUTPUT_FIFO0_ADDR A:0x678b8110
y.create.l HWIO_BLSP1_BLSP_QUP3_QUP_OUTPUT_FIFO1_ADDR A:0x678b8114
y.create.l HWIO_BLSP1_BLSP_QUP3_QUP_OUTPUT_FIFO2_ADDR A:0x678b8118
y.create.l HWIO_BLSP1_BLSP_QUP3_QUP_OUTPUT_FIFO3_ADDR A:0x678b811c
y.create.l HWIO_BLSP1_BLSP_QUP3_QUP_OUTPUT_FIFO4_ADDR A:0x678b8120
y.create.l HWIO_BLSP1_BLSP_QUP3_QUP_OUTPUT_FIFO5_ADDR A:0x678b8124
y.create.l HWIO_BLSP1_BLSP_QUP3_QUP_OUTPUT_FIFO6_ADDR A:0x678b8128
y.create.l HWIO_BLSP1_BLSP_QUP3_QUP_OUTPUT_FIFO7_ADDR A:0x678b812c
y.create.l HWIO_BLSP1_BLSP_QUP3_QUP_OUTPUT_FIFO8_ADDR A:0x678b8130
y.create.l HWIO_BLSP1_BLSP_QUP3_QUP_OUTPUT_FIFO9_ADDR A:0x678b8134
y.create.l HWIO_BLSP1_BLSP_QUP3_QUP_MX_WRITE_COUNT_ADDR A:0x678b8150
y.create.l HWIO_BLSP1_BLSP_QUP3_QUP_MX_WRITE_CNT_CURRENT_ADDR A:0x678b8154
y.create.l HWIO_BLSP1_BLSP_QUP3_QUP_MX_INPUT_COUNT_ADDR A:0x678b8200
y.create.l HWIO_BLSP1_BLSP_QUP3_QUP_MX_INPUT_CNT_CURRENT_ADDR A:0x678b8204
y.create.l HWIO_BLSP1_BLSP_QUP3_QUP_MX_READ_COUNT_ADDR A:0x678b8208
y.create.l HWIO_BLSP1_BLSP_QUP3_QUP_MX_READ_CNT_CURRENT_ADDR A:0x678b820c
y.create.l HWIO_BLSP1_BLSP_QUP3_QUP_INPUT_DEBUG_ADDR A:0x678b8210
y.create.l HWIO_BLSP1_BLSP_QUP3_QUP_INPUT_FIFO_WORD_CNT_ADDR A:0x678b8214
y.create.l HWIO_BLSP1_BLSP_QUP3_QUP_INPUT_FIFO0_ADDR A:0x678b8218
y.create.l HWIO_BLSP1_BLSP_QUP3_QUP_INPUT_FIFO1_ADDR A:0x678b821c
y.create.l HWIO_BLSP1_BLSP_QUP3_QUP_INPUT_FIFO2_ADDR A:0x678b8220
y.create.l HWIO_BLSP1_BLSP_QUP3_QUP_INPUT_FIFO3_ADDR A:0x678b8224
y.create.l HWIO_BLSP1_BLSP_QUP3_QUP_INPUT_FIFO4_ADDR A:0x678b8228
y.create.l HWIO_BLSP1_BLSP_QUP3_QUP_INPUT_FIFO5_ADDR A:0x678b822c
y.create.l HWIO_BLSP1_BLSP_QUP3_QUP_INPUT_FIFO6_ADDR A:0x678b8230
y.create.l HWIO_BLSP1_BLSP_QUP3_QUP_INPUT_FIFO7_ADDR A:0x678b8234
y.create.l HWIO_BLSP1_BLSP_QUP3_QUP_INPUT_FIFO8_ADDR A:0x678b8238
y.create.l HWIO_BLSP1_BLSP_QUP3_QUP_INPUT_FIFO9_ADDR A:0x678b823c
y.create.l HWIO_BLSP1_BLSP_QUP3_SPI_CONFIG_ADDR A:0x678b8300
y.create.l HWIO_BLSP1_BLSP_QUP3_SPI_IO_CONTROL_ADDR A:0x678b8304
y.create.l HWIO_BLSP1_BLSP_QUP3_SPI_ERROR_FLAGS_ADDR A:0x678b8308
y.create.l HWIO_BLSP1_BLSP_QUP3_SPI_ERROR_FLAGS_EN_ADDR A:0x678b830c
y.create.l HWIO_BLSP1_BLSP_QUP3_SPI_DEASSERT_WAIT_ADDR A:0x678b8310
y.create.l HWIO_BLSP1_BLSP_QUP3_SPI_MASTER_LOCAL_ID_ADDR A:0x678b8314
y.create.l HWIO_BLSP1_BLSP_QUP3_SPI_MASTER_COMMAND_ADDR A:0x678b8318
y.create.l HWIO_BLSP1_BLSP_QUP3_SPI_MASTER_STATUS_ADDR A:0x678b831c
y.create.l HWIO_BLSP1_BLSP_QUP3_SPI_CHAR_CFG_ADDR A:0x678b8320
y.create.l HWIO_BLSP1_BLSP_QUP3_SPI_CHAR_DATA_SPI_CS_ADDR A:0x678b8324
y.create.l HWIO_BLSP1_BLSP_QUP3_SPI_CHAR_DATA_SPI_MOSI_ADDR A:0x678b8328
y.create.l HWIO_BLSP1_BLSP_QUP3_SPI_CHAR_DATA_SPI_MISO_ADDR A:0x678b832c
y.create.l HWIO_BLSP1_BLSP_QUP3_I2C_MASTER_CLK_CTL_ADDR A:0x678b8400
y.create.l HWIO_BLSP1_BLSP_QUP3_I2C_MASTER_STATUS_ADDR A:0x678b8404
y.create.l HWIO_BLSP1_BLSP_QUP3_I2C_MASTER_CONFIG_ADDR A:0x678b8408
y.create.l HWIO_BLSP1_BLSP_QUP3_I2C_MASTER_BUS_CLEAR_ADDR A:0x678b840c
y.create.l HWIO_BLSP1_BLSP_QUP3_I2C_MASTER_LOCAL_ID_ADDR A:0x678b8410
y.create.l HWIO_BLSP1_BLSP_QUP3_I2C_MASTER_COMMAND_ADDR A:0x678b8414
y.create.l HWIO_BLSP1_BLSP_QUP4_QUP_CONFIG_ADDR A:0x678b9000
y.create.l HWIO_BLSP1_BLSP_QUP4_QUP_STATE_ADDR A:0x678b9004
y.create.l HWIO_BLSP1_BLSP_QUP4_QUP_IO_MODES_ADDR A:0x678b9008
y.create.l HWIO_BLSP1_BLSP_QUP4_QUP_SW_RESET_ADDR A:0x678b900c
y.create.l HWIO_BLSP1_BLSP_QUP4_QUP_TRANSFER_CANCEL_ADDR A:0x678b9014
y.create.l HWIO_BLSP1_BLSP_QUP4_QUP_OPERATIONAL_ADDR A:0x678b9018
y.create.l HWIO_BLSP1_BLSP_QUP4_QUP_ERROR_FLAGS_ADDR A:0x678b901c
y.create.l HWIO_BLSP1_BLSP_QUP4_QUP_ERROR_FLAGS_EN_ADDR A:0x678b9020
y.create.l HWIO_BLSP1_BLSP_QUP4_QUP_TEST_CTRL_ADDR A:0x678b9024
y.create.l HWIO_BLSP1_BLSP_QUP4_QUP_OPERATIONAL_MASK_ADDR A:0x678b9028
y.create.l HWIO_BLSP1_BLSP_QUP4_QUP_HW_VERSION_ADDR A:0x678b9030
y.create.l HWIO_BLSP1_BLSP_QUP4_QUP_MX_OUTPUT_COUNT_ADDR A:0x678b9100
y.create.l HWIO_BLSP1_BLSP_QUP4_QUP_MX_OUTPUT_CNT_CURRENT_ADDR A:0x678b9104
y.create.l HWIO_BLSP1_BLSP_QUP4_QUP_OUTPUT_DEBUG_ADDR A:0x678b9108
y.create.l HWIO_BLSP1_BLSP_QUP4_QUP_OUTPUT_FIFO_WORD_CNT_ADDR A:0x678b910c
y.create.l HWIO_BLSP1_BLSP_QUP4_QUP_OUTPUT_FIFO0_ADDR A:0x678b9110
y.create.l HWIO_BLSP1_BLSP_QUP4_QUP_OUTPUT_FIFO1_ADDR A:0x678b9114
y.create.l HWIO_BLSP1_BLSP_QUP4_QUP_OUTPUT_FIFO2_ADDR A:0x678b9118
y.create.l HWIO_BLSP1_BLSP_QUP4_QUP_OUTPUT_FIFO3_ADDR A:0x678b911c
y.create.l HWIO_BLSP1_BLSP_QUP4_QUP_OUTPUT_FIFO4_ADDR A:0x678b9120
y.create.l HWIO_BLSP1_BLSP_QUP4_QUP_OUTPUT_FIFO5_ADDR A:0x678b9124
y.create.l HWIO_BLSP1_BLSP_QUP4_QUP_OUTPUT_FIFO6_ADDR A:0x678b9128
y.create.l HWIO_BLSP1_BLSP_QUP4_QUP_OUTPUT_FIFO7_ADDR A:0x678b912c
y.create.l HWIO_BLSP1_BLSP_QUP4_QUP_OUTPUT_FIFO8_ADDR A:0x678b9130
y.create.l HWIO_BLSP1_BLSP_QUP4_QUP_OUTPUT_FIFO9_ADDR A:0x678b9134
y.create.l HWIO_BLSP1_BLSP_QUP4_QUP_MX_WRITE_COUNT_ADDR A:0x678b9150
y.create.l HWIO_BLSP1_BLSP_QUP4_QUP_MX_WRITE_CNT_CURRENT_ADDR A:0x678b9154
y.create.l HWIO_BLSP1_BLSP_QUP4_QUP_MX_INPUT_COUNT_ADDR A:0x678b9200
y.create.l HWIO_BLSP1_BLSP_QUP4_QUP_MX_INPUT_CNT_CURRENT_ADDR A:0x678b9204
y.create.l HWIO_BLSP1_BLSP_QUP4_QUP_MX_READ_COUNT_ADDR A:0x678b9208
y.create.l HWIO_BLSP1_BLSP_QUP4_QUP_MX_READ_CNT_CURRENT_ADDR A:0x678b920c
y.create.l HWIO_BLSP1_BLSP_QUP4_QUP_INPUT_DEBUG_ADDR A:0x678b9210
y.create.l HWIO_BLSP1_BLSP_QUP4_QUP_INPUT_FIFO_WORD_CNT_ADDR A:0x678b9214
y.create.l HWIO_BLSP1_BLSP_QUP4_QUP_INPUT_FIFO0_ADDR A:0x678b9218
y.create.l HWIO_BLSP1_BLSP_QUP4_QUP_INPUT_FIFO1_ADDR A:0x678b921c
y.create.l HWIO_BLSP1_BLSP_QUP4_QUP_INPUT_FIFO2_ADDR A:0x678b9220
y.create.l HWIO_BLSP1_BLSP_QUP4_QUP_INPUT_FIFO3_ADDR A:0x678b9224
y.create.l HWIO_BLSP1_BLSP_QUP4_QUP_INPUT_FIFO4_ADDR A:0x678b9228
y.create.l HWIO_BLSP1_BLSP_QUP4_QUP_INPUT_FIFO5_ADDR A:0x678b922c
y.create.l HWIO_BLSP1_BLSP_QUP4_QUP_INPUT_FIFO6_ADDR A:0x678b9230
y.create.l HWIO_BLSP1_BLSP_QUP4_QUP_INPUT_FIFO7_ADDR A:0x678b9234
y.create.l HWIO_BLSP1_BLSP_QUP4_QUP_INPUT_FIFO8_ADDR A:0x678b9238
y.create.l HWIO_BLSP1_BLSP_QUP4_QUP_INPUT_FIFO9_ADDR A:0x678b923c
y.create.l HWIO_BLSP1_BLSP_QUP4_SPI_CONFIG_ADDR A:0x678b9300
y.create.l HWIO_BLSP1_BLSP_QUP4_SPI_IO_CONTROL_ADDR A:0x678b9304
y.create.l HWIO_BLSP1_BLSP_QUP4_SPI_ERROR_FLAGS_ADDR A:0x678b9308
y.create.l HWIO_BLSP1_BLSP_QUP4_SPI_ERROR_FLAGS_EN_ADDR A:0x678b930c
y.create.l HWIO_BLSP1_BLSP_QUP4_SPI_DEASSERT_WAIT_ADDR A:0x678b9310
y.create.l HWIO_BLSP1_BLSP_QUP4_SPI_MASTER_LOCAL_ID_ADDR A:0x678b9314
y.create.l HWIO_BLSP1_BLSP_QUP4_SPI_MASTER_COMMAND_ADDR A:0x678b9318
y.create.l HWIO_BLSP1_BLSP_QUP4_SPI_MASTER_STATUS_ADDR A:0x678b931c
y.create.l HWIO_BLSP1_BLSP_QUP4_SPI_CHAR_CFG_ADDR A:0x678b9320
y.create.l HWIO_BLSP1_BLSP_QUP4_SPI_CHAR_DATA_SPI_CS_ADDR A:0x678b9324
y.create.l HWIO_BLSP1_BLSP_QUP4_SPI_CHAR_DATA_SPI_MOSI_ADDR A:0x678b9328
y.create.l HWIO_BLSP1_BLSP_QUP4_SPI_CHAR_DATA_SPI_MISO_ADDR A:0x678b932c
y.create.l HWIO_BLSP1_BLSP_QUP4_I2C_MASTER_CLK_CTL_ADDR A:0x678b9400
y.create.l HWIO_BLSP1_BLSP_QUP4_I2C_MASTER_STATUS_ADDR A:0x678b9404
y.create.l HWIO_BLSP1_BLSP_QUP4_I2C_MASTER_CONFIG_ADDR A:0x678b9408
y.create.l HWIO_BLSP1_BLSP_QUP4_I2C_MASTER_BUS_CLEAR_ADDR A:0x678b940c
y.create.l HWIO_BLSP1_BLSP_QUP4_I2C_MASTER_LOCAL_ID_ADDR A:0x678b9410
y.create.l HWIO_BLSP1_BLSP_QUP4_I2C_MASTER_COMMAND_ADDR A:0x678b9414
y.create.l HWIO_BLSP1_BLSP_QUP5_QUP_CONFIG_ADDR A:0x678ba000
y.create.l HWIO_BLSP1_BLSP_QUP5_QUP_STATE_ADDR A:0x678ba004
y.create.l HWIO_BLSP1_BLSP_QUP5_QUP_IO_MODES_ADDR A:0x678ba008
y.create.l HWIO_BLSP1_BLSP_QUP5_QUP_SW_RESET_ADDR A:0x678ba00c
y.create.l HWIO_BLSP1_BLSP_QUP5_QUP_TRANSFER_CANCEL_ADDR A:0x678ba014
y.create.l HWIO_BLSP1_BLSP_QUP5_QUP_OPERATIONAL_ADDR A:0x678ba018
y.create.l HWIO_BLSP1_BLSP_QUP5_QUP_ERROR_FLAGS_ADDR A:0x678ba01c
y.create.l HWIO_BLSP1_BLSP_QUP5_QUP_ERROR_FLAGS_EN_ADDR A:0x678ba020
y.create.l HWIO_BLSP1_BLSP_QUP5_QUP_TEST_CTRL_ADDR A:0x678ba024
y.create.l HWIO_BLSP1_BLSP_QUP5_QUP_OPERATIONAL_MASK_ADDR A:0x678ba028
y.create.l HWIO_BLSP1_BLSP_QUP5_QUP_HW_VERSION_ADDR A:0x678ba030
y.create.l HWIO_BLSP1_BLSP_QUP5_QUP_MX_OUTPUT_COUNT_ADDR A:0x678ba100
y.create.l HWIO_BLSP1_BLSP_QUP5_QUP_MX_OUTPUT_CNT_CURRENT_ADDR A:0x678ba104
y.create.l HWIO_BLSP1_BLSP_QUP5_QUP_OUTPUT_DEBUG_ADDR A:0x678ba108
y.create.l HWIO_BLSP1_BLSP_QUP5_QUP_OUTPUT_FIFO_WORD_CNT_ADDR A:0x678ba10c
y.create.l HWIO_BLSP1_BLSP_QUP5_QUP_OUTPUT_FIFO0_ADDR A:0x678ba110
y.create.l HWIO_BLSP1_BLSP_QUP5_QUP_OUTPUT_FIFO1_ADDR A:0x678ba114
y.create.l HWIO_BLSP1_BLSP_QUP5_QUP_OUTPUT_FIFO2_ADDR A:0x678ba118
y.create.l HWIO_BLSP1_BLSP_QUP5_QUP_OUTPUT_FIFO3_ADDR A:0x678ba11c
y.create.l HWIO_BLSP1_BLSP_QUP5_QUP_OUTPUT_FIFO4_ADDR A:0x678ba120
y.create.l HWIO_BLSP1_BLSP_QUP5_QUP_OUTPUT_FIFO5_ADDR A:0x678ba124
y.create.l HWIO_BLSP1_BLSP_QUP5_QUP_OUTPUT_FIFO6_ADDR A:0x678ba128
y.create.l HWIO_BLSP1_BLSP_QUP5_QUP_OUTPUT_FIFO7_ADDR A:0x678ba12c
y.create.l HWIO_BLSP1_BLSP_QUP5_QUP_OUTPUT_FIFO8_ADDR A:0x678ba130
y.create.l HWIO_BLSP1_BLSP_QUP5_QUP_OUTPUT_FIFO9_ADDR A:0x678ba134
y.create.l HWIO_BLSP1_BLSP_QUP5_QUP_MX_WRITE_COUNT_ADDR A:0x678ba150
y.create.l HWIO_BLSP1_BLSP_QUP5_QUP_MX_WRITE_CNT_CURRENT_ADDR A:0x678ba154
y.create.l HWIO_BLSP1_BLSP_QUP5_QUP_MX_INPUT_COUNT_ADDR A:0x678ba200
y.create.l HWIO_BLSP1_BLSP_QUP5_QUP_MX_INPUT_CNT_CURRENT_ADDR A:0x678ba204
y.create.l HWIO_BLSP1_BLSP_QUP5_QUP_MX_READ_COUNT_ADDR A:0x678ba208
y.create.l HWIO_BLSP1_BLSP_QUP5_QUP_MX_READ_CNT_CURRENT_ADDR A:0x678ba20c
y.create.l HWIO_BLSP1_BLSP_QUP5_QUP_INPUT_DEBUG_ADDR A:0x678ba210
y.create.l HWIO_BLSP1_BLSP_QUP5_QUP_INPUT_FIFO_WORD_CNT_ADDR A:0x678ba214
y.create.l HWIO_BLSP1_BLSP_QUP5_QUP_INPUT_FIFO0_ADDR A:0x678ba218
y.create.l HWIO_BLSP1_BLSP_QUP5_QUP_INPUT_FIFO1_ADDR A:0x678ba21c
y.create.l HWIO_BLSP1_BLSP_QUP5_QUP_INPUT_FIFO2_ADDR A:0x678ba220
y.create.l HWIO_BLSP1_BLSP_QUP5_QUP_INPUT_FIFO3_ADDR A:0x678ba224
y.create.l HWIO_BLSP1_BLSP_QUP5_QUP_INPUT_FIFO4_ADDR A:0x678ba228
y.create.l HWIO_BLSP1_BLSP_QUP5_QUP_INPUT_FIFO5_ADDR A:0x678ba22c
y.create.l HWIO_BLSP1_BLSP_QUP5_QUP_INPUT_FIFO6_ADDR A:0x678ba230
y.create.l HWIO_BLSP1_BLSP_QUP5_QUP_INPUT_FIFO7_ADDR A:0x678ba234
y.create.l HWIO_BLSP1_BLSP_QUP5_QUP_INPUT_FIFO8_ADDR A:0x678ba238
y.create.l HWIO_BLSP1_BLSP_QUP5_QUP_INPUT_FIFO9_ADDR A:0x678ba23c
y.create.l HWIO_BLSP1_BLSP_QUP5_SPI_CONFIG_ADDR A:0x678ba300
y.create.l HWIO_BLSP1_BLSP_QUP5_SPI_IO_CONTROL_ADDR A:0x678ba304
y.create.l HWIO_BLSP1_BLSP_QUP5_SPI_ERROR_FLAGS_ADDR A:0x678ba308
y.create.l HWIO_BLSP1_BLSP_QUP5_SPI_ERROR_FLAGS_EN_ADDR A:0x678ba30c
y.create.l HWIO_BLSP1_BLSP_QUP5_SPI_DEASSERT_WAIT_ADDR A:0x678ba310
y.create.l HWIO_BLSP1_BLSP_QUP5_SPI_MASTER_LOCAL_ID_ADDR A:0x678ba314
y.create.l HWIO_BLSP1_BLSP_QUP5_SPI_MASTER_COMMAND_ADDR A:0x678ba318
y.create.l HWIO_BLSP1_BLSP_QUP5_SPI_MASTER_STATUS_ADDR A:0x678ba31c
y.create.l HWIO_BLSP1_BLSP_QUP5_SPI_CHAR_CFG_ADDR A:0x678ba320
y.create.l HWIO_BLSP1_BLSP_QUP5_SPI_CHAR_DATA_SPI_CS_ADDR A:0x678ba324
y.create.l HWIO_BLSP1_BLSP_QUP5_SPI_CHAR_DATA_SPI_MOSI_ADDR A:0x678ba328
y.create.l HWIO_BLSP1_BLSP_QUP5_SPI_CHAR_DATA_SPI_MISO_ADDR A:0x678ba32c
y.create.l HWIO_BLSP1_BLSP_QUP5_I2C_MASTER_CLK_CTL_ADDR A:0x678ba400
y.create.l HWIO_BLSP1_BLSP_QUP5_I2C_MASTER_STATUS_ADDR A:0x678ba404
y.create.l HWIO_BLSP1_BLSP_QUP5_I2C_MASTER_CONFIG_ADDR A:0x678ba408
y.create.l HWIO_BLSP1_BLSP_QUP5_I2C_MASTER_BUS_CLEAR_ADDR A:0x678ba40c
y.create.l HWIO_BLSP1_BLSP_QUP5_I2C_MASTER_LOCAL_ID_ADDR A:0x678ba410
y.create.l HWIO_BLSP1_BLSP_QUP5_I2C_MASTER_COMMAND_ADDR A:0x678ba414
y.create.l HWIO_BOOT_ROM_XPU_SCR_ADDR A:0x601ff000
y.create.l HWIO_BOOT_ROM_XPU_SWDR_ADDR A:0x601ff004
y.create.l HWIO_BOOT_ROM_XPU_PRTN_RACR_SSHADOW_ADDR A:0x601ff008
y.create.l HWIO_BOOT_ROM_XPU_PRTN_START_SSHADOW0_ADDR A:0x601ff010
y.create.l HWIO_BOOT_ROM_XPU_PRTN_END_SSHADOW0_ADDR A:0x601ff018
y.create.l HWIO_BOOT_ROM_XPU_SEAR0_ADDR A:0x601ff040
y.create.l HWIO_BOOT_ROM_XPU_SESR_ADDR A:0x601ff048
y.create.l HWIO_BOOT_ROM_XPU_SESRRESTORE_ADDR A:0x601ff04c
y.create.l HWIO_BOOT_ROM_XPU_SESYNR0_ADDR A:0x601ff050
y.create.l HWIO_BOOT_ROM_XPU_SESYNR1_ADDR A:0x601ff054
y.create.l HWIO_BOOT_ROM_XPU_SESYNR2_ADDR A:0x601ff058
y.create.l HWIO_BOOT_ROM_XPU_MCR_ADDR A:0x601ff100
y.create.l HWIO_BOOT_ROM_XPU_MEAR0_ADDR A:0x601ff140
y.create.l HWIO_BOOT_ROM_XPU_MESR_ADDR A:0x601ff148
y.create.l HWIO_BOOT_ROM_XPU_MESRRESTORE_ADDR A:0x601ff14c
y.create.l HWIO_BOOT_ROM_XPU_MESYNR0_ADDR A:0x601ff150
y.create.l HWIO_BOOT_ROM_XPU_MESYNR1_ADDR A:0x601ff154
y.create.l HWIO_BOOT_ROM_XPU_MESYNR2_ADDR A:0x601ff158
y.create.l HWIO_BOOT_ROM_XPU_CR_ADDR A:0x601ff080
y.create.l HWIO_BOOT_ROM_XPU_PRTN_RACR_SHADOW_ADDR A:0x601ff088
y.create.l HWIO_BOOT_ROM_XPU_PRTN_START_SHADOW0_ADDR A:0x601ff090
y.create.l HWIO_BOOT_ROM_XPU_PRTN_END_SHADOW0_ADDR A:0x601ff098
y.create.l HWIO_BOOT_ROM_XPU_RPU_ACR0_ADDR A:0x601ff0a0
y.create.l HWIO_BOOT_ROM_XPU_EAR0_ADDR A:0x601ff0c0
y.create.l HWIO_BOOT_ROM_XPU_ESR_ADDR A:0x601ff0c8
y.create.l HWIO_BOOT_ROM_XPU_ESRRESTORE_ADDR A:0x601ff0cc
y.create.l HWIO_BOOT_ROM_XPU_ESYNR0_ADDR A:0x601ff0d0
y.create.l HWIO_BOOT_ROM_XPU_ESYNR1_ADDR A:0x601ff0d4
y.create.l HWIO_BOOT_ROM_XPU_ESYNR2_ADDR A:0x601ff0d8
y.create.l HWIO_BOOT_ROM_XPU_UMR_RACR_ADDR A:0x601ff0e0
y.create.l HWIO_BOOT_ROM_XPU_UMR_WACR_ADDR A:0x601ff0e4
y.create.l HWIO_BOOT_ROM_XPU_UMR_CNTL_ADDR A:0x601ff0f0
y.create.l HWIO_BOOT_ROM_XPU_IDR0_ADDR A:0x601ff074
y.create.l HWIO_BOOT_ROM_XPU_IDR1_ADDR A:0x601ff078
y.create.l HWIO_BOOT_ROM_XPU_REV_ADDR A:0x601ff07c
y.create.l HWIO_BOOT_ROM_XPU_PRT0_RACR0_ADDR A:0x601ff200
y.create.l HWIO_BOOT_ROM_XPU_PRT1_RACR0_ADDR A:0x601ff280
y.create.l HWIO_BOOT_ROM_XPU_PRT2_RACR0_ADDR A:0x601ff300
y.create.l HWIO_BOOT_ROM_XPU_PRT0_START0_ADDR A:0x601ff240
y.create.l HWIO_BOOT_ROM_XPU_PRT1_START0_ADDR A:0x601ff2c0
y.create.l HWIO_BOOT_ROM_XPU_PRT2_START0_ADDR A:0x601ff340
y.create.l HWIO_BOOT_ROM_XPU_PRT0_END0_ADDR A:0x601ff248
y.create.l HWIO_BOOT_ROM_XPU_PRT1_END0_ADDR A:0x601ff2c8
y.create.l HWIO_BOOT_ROM_XPU_PRT2_END0_ADDR A:0x601ff348
y.create.l HWIO_BOOT_ROM_XPU_PRT0_SCR_ADDR A:0x601ff250
y.create.l HWIO_BOOT_ROM_XPU_PRT1_SCR_ADDR A:0x601ff2d0
y.create.l HWIO_BOOT_ROM_XPU_PRT2_SCR_ADDR A:0x601ff350
y.create.l HWIO_BOOT_ROM_XPU_PRT0_MCR_ADDR A:0x601ff254
y.create.l HWIO_BOOT_ROM_XPU_PRT1_MCR_ADDR A:0x601ff2d4
y.create.l HWIO_BOOT_ROM_XPU_PRT2_MCR_ADDR A:0x601ff354
y.create.l HWIO_BOOT_ROM_XPU_PRT0_CNTL0_ADDR A:0x601ff258
y.create.l HWIO_BOOT_ROM_XPU_PRT1_CNTL0_ADDR A:0x601ff2d8
y.create.l HWIO_BOOT_ROM_XPU_PRT2_CNTL0_ADDR A:0x601ff358
y.create.l HWIO_BOOT_ROM_XPU_PRT0_CNTL1_ADDR A:0x601ff25c
y.create.l HWIO_BOOT_ROM_XPU_PRT1_CNTL1_ADDR A:0x601ff2dc
y.create.l HWIO_BOOT_ROM_XPU_PRT2_CNTL1_ADDR A:0x601ff35c
y.create.l HWIO_CAMSS_A_CAMSS_HW_VERSION_ADDR A:0x61b00000
y.create.l HWIO_CAMSS_A_CAMSS_TESTBUS_SEL_ADDR A:0x61b00004
y.create.l HWIO_CAMSS_A_CAMSS_GPIO_MUX_SEL_ADDR A:0x61b00008
y.create.l HWIO_CAMSS_A_CAMSS_AHB_ARB_CTL_ADDR A:0x61b0000c
y.create.l HWIO_CAMSS_A_CAMSS_XPU2_STATUS_ADDR A:0x61b00010
y.create.l HWIO_CAMSS_A_CAMSS_CSI_PIX_CLK_MUX_SEL_ADDR A:0x61b00020
y.create.l HWIO_CAMSS_A_CAMSS_CSI_PIX_CLK_CGC_EN_ADDR A:0x61b00024
y.create.l HWIO_CAMSS_A_CAMSS_CSI_RDI_CLK_MUX_SEL_ADDR A:0x61b00028
y.create.l HWIO_CAMSS_A_CAMSS_CSI_RDI_CLK_CGC_EN_ADDR A:0x61b0002c
y.create.l HWIO_CAMSS_A_CAMSS_CSI_PHY_0_CLK_MUX_SEL_ADDR A:0x61b00030
y.create.l HWIO_CAMSS_A_CAMSS_CSI_PHY_0_CLK_CGC_EN_ADDR A:0x61b00034
y.create.l HWIO_CAMSS_A_CAMSS_CSI_PHY_1_CLK_MUX_SEL_ADDR A:0x61b00038
y.create.l HWIO_CAMSS_A_CAMSS_CSI_PHY_1_CLK_CGC_EN_ADDR A:0x61b0003c
y.create.l HWIO_CAMSS_A_CAMSS_CSI_PHY_2_CLK_MUX_SEL_ADDR A:0x61b00040
y.create.l HWIO_CAMSS_A_CAMSS_CSI_PHY_2_CLK_CGC_EN_ADDR A:0x61b00044
y.create.l HWIO_CAMSS_A_CAMSS_JPEG_FORCE_CLK_ON_ADDR A:0x61b00050
y.create.l HWIO_CAMSS_A_CAMSS_CPP_FORCE_CLK_ON_ADDR A:0x61b00054
y.create.l HWIO_CAMSS_A_CAMSS_VFE_FORCE_CLK_ON_ADDR A:0x61b00058
y.create.l HWIO_CAMSS_A_CAMSS_CCI_FORCE_CLK_ON_ADDR A:0x61b0005c
y.create.l HWIO_CAMSS_A_CAMSS_IRQ_COMPOSITE_RESET_CTRL_ADDR A:0x61b00060
y.create.l HWIO_CAMSS_A_CAMSS_IRQ_COMPOSITE_MASK_0_ADDR A:0x61b00064
y.create.l HWIO_CAMSS_A_CAMSS_IRQ_COMPOSITE_MASK_1_ADDR A:0x61b00068
y.create.l HWIO_CAMSS_A_CAMSS_IRQ_COMPOSITE_MASK_2_ADDR A:0x61b0006c
y.create.l HWIO_CAMSS_A_CAMSS_IRQ_COMPOSITE_MASK_3_ADDR A:0x61b00070
y.create.l HWIO_CAMSS_A_CAMSS_IRQ_COMPOSITE_MASK_4_ADDR A:0x61b00074
y.create.l HWIO_CAMSS_A_CAMSS_IRQ_COMPOSITE_MASK_5_ADDR A:0x61b00078
y.create.l HWIO_CAMSS_A_CAMSS_IRQ_COMPOSITE_MASK_6_ADDR A:0x61b0007c
y.create.l HWIO_CAMSS_A_CAMSS_IRQ_COMPOSITE_MASK_7_ADDR A:0x61b00080
y.create.l HWIO_CAMSS_A_CAMSS_IRQ_COMPOSITE_MASK_8_ADDR A:0x61b00084
y.create.l HWIO_CAMSS_A_CAMSS_IRQ_COMPOSITE_MASK_9_ADDR A:0x61b00088
y.create.l HWIO_CAMSS_A_CAMSS_IRQ_COMPOSITE_MASK_10_ADDR A:0x61b0008c
y.create.l HWIO_CAMSS_A_CAMSS_IRQ_COMPOSITE_MASK_11_ADDR A:0x61b00090
y.create.l HWIO_CAMSS_A_CAMSS_IRQ_COMPOSITE_MASK_12_ADDR A:0x61b00094
y.create.l HWIO_CAMSS_A_CAMSS_IRQ_COMPOSITE_MICRO_MASK_0_ADDR A:0x61b000a4
y.create.l HWIO_CAMSS_A_CAMSS_IRQ_COMPOSITE_MICRO_MASK_1_ADDR A:0x61b000a8
y.create.l HWIO_CAMSS_A_CAMSS_IRQ_COMPOSITE_MICRO_MASK_2_ADDR A:0x61b000ac
y.create.l HWIO_CAMSS_A_CAMSS_IRQ_COMPOSITE_MICRO_MASK_3_ADDR A:0x61b000b0
y.create.l HWIO_CAMSS_A_CAMSS_IRQ_COMPOSITE_MICRO_MASK_4_ADDR A:0x61b000b4
y.create.l HWIO_CAMSS_A_CAMSS_IRQ_COMPOSITE_MICRO_MASK_5_ADDR A:0x61b000b8
y.create.l HWIO_CAMSS_A_CAMSS_SPARE_ADDR A:0x61b000fc
y.create.l HWIO_CAMSS_A_CSID_0_CSID_HW_VERSION_ADDR A:0x61b08000
y.create.l HWIO_CAMSS_A_CSID_0_CSID_CORE_CTRL_0_ADDR A:0x61b08004
y.create.l HWIO_CAMSS_A_CSID_0_CSID_CORE_CTRL_1_ADDR A:0x61b08008
y.create.l HWIO_CAMSS_A_CSID_0_CSID_RST_CMD_ADDR A:0x61b0800c
y.create.l HWIO_CAMSS_A_CSID_0_CSID_CID_LUT_VC_0_ADDR A:0x61b08010
y.create.l HWIO_CAMSS_A_CSID_0_CSID_CID_LUT_VC_1_ADDR A:0x61b08014
y.create.l HWIO_CAMSS_A_CSID_0_CSID_CID_LUT_VC_2_ADDR A:0x61b08018
y.create.l HWIO_CAMSS_A_CSID_0_CSID_CID_LUT_VC_3_ADDR A:0x61b0801c
y.create.l HWIO_CAMSS_A_CSID_0_CSID_CID_0_CFG_ADDR A:0x61b08020
y.create.l HWIO_CAMSS_A_CSID_0_CSID_CID_1_CFG_ADDR A:0x61b08024
y.create.l HWIO_CAMSS_A_CSID_0_CSID_CID_2_CFG_ADDR A:0x61b08028
y.create.l HWIO_CAMSS_A_CSID_0_CSID_CID_3_CFG_ADDR A:0x61b0802c
y.create.l HWIO_CAMSS_A_CSID_0_CSID_CID_4_CFG_ADDR A:0x61b08030
y.create.l HWIO_CAMSS_A_CSID_0_CSID_CID_5_CFG_ADDR A:0x61b08034
y.create.l HWIO_CAMSS_A_CSID_0_CSID_CID_6_CFG_ADDR A:0x61b08038
y.create.l HWIO_CAMSS_A_CSID_0_CSID_CID_7_CFG_ADDR A:0x61b0803c
y.create.l HWIO_CAMSS_A_CSID_0_CSID_CID_8_CFG_ADDR A:0x61b08040
y.create.l HWIO_CAMSS_A_CSID_0_CSID_CID_9_CFG_ADDR A:0x61b08044
y.create.l HWIO_CAMSS_A_CSID_0_CSID_IRQ_CLEAR_CMD_ADDR A:0x61b08060
y.create.l HWIO_CAMSS_A_CSID_0_CSID_IRQ_MASK_ADDR A:0x61b08064
y.create.l HWIO_CAMSS_A_CSID_0_CSID_IRQ_STATUS_ADDR A:0x61b08068
y.create.l HWIO_CAMSS_A_CSID_0_CSID_CAPTURED_UNMAPPED_LONG_PKT_HDR_ADDR A:0x61b0806c
y.create.l HWIO_CAMSS_A_CSID_0_CSID_CAPTURED_MMAPPED_LONG_PKT_HDR_ADDR A:0x61b08070
y.create.l HWIO_CAMSS_A_CSID_0_CSID_CAPTURED_SHORT_PKT_ADDR A:0x61b08074
y.create.l HWIO_CAMSS_A_CSID_0_CSID_CAPTURED_LONG_PKT_HDR_ADDR A:0x61b08078
y.create.l HWIO_CAMSS_A_CSID_0_CSID_CAPTURED_LONG_PKT_FTR_ADDR A:0x61b0807c
y.create.l HWIO_CAMSS_A_CSID_0_CSID_PIF_MISR_DL0_ADDR A:0x61b08080
y.create.l HWIO_CAMSS_A_CSID_0_CSID_PIF_MISR_DL1_ADDR A:0x61b08084
y.create.l HWIO_CAMSS_A_CSID_0_CSID_PIF_MISR_DL2_ADDR A:0x61b08088
y.create.l HWIO_CAMSS_A_CSID_0_CSID_PIF_MISR_DL3_ADDR A:0x61b0808c
y.create.l HWIO_CAMSS_A_CSID_0_CSID_STATS_TOTAL_PKTS_RCVD_ADDR A:0x61b08090
y.create.l HWIO_CAMSS_A_CSID_0_CSID_STATS_ECC_ADDR A:0x61b08094
y.create.l HWIO_CAMSS_A_CSID_0_CSID_STATS_CRC_ADDR A:0x61b08098
y.create.l HWIO_CAMSS_A_CSID_0_CSID_TEST_BUS_CTRL_ADDR A:0x61b0809c
y.create.l HWIO_CAMSS_A_CSID_0_CSID_TG_CTRL_ADDR A:0x61b080a0
y.create.l HWIO_CAMSS_A_CSID_0_CSID_TG_VC_CFG_ADDR A:0x61b080a4
y.create.l HWIO_CAMSS_A_CSID_0_CSID_TG_PAYLOAD_LFSR_SEED_ADDR A:0x61b080a8
y.create.l HWIO_CAMSS_A_CSID_0_CSID_TG_DT_0_CFG_0_ADDR A:0x61b080ac
y.create.l HWIO_CAMSS_A_CSID_0_CSID_TG_DT_1_CFG_0_ADDR A:0x61b080b8
y.create.l HWIO_CAMSS_A_CSID_0_CSID_TG_DT_2_CFG_0_ADDR A:0x61b080c4
y.create.l HWIO_CAMSS_A_CSID_0_CSID_TG_DT_3_CFG_0_ADDR A:0x61b080d0
y.create.l HWIO_CAMSS_A_CSID_0_CSID_TG_DT_0_CFG_1_ADDR A:0x61b080b0
y.create.l HWIO_CAMSS_A_CSID_0_CSID_TG_DT_1_CFG_1_ADDR A:0x61b080bc
y.create.l HWIO_CAMSS_A_CSID_0_CSID_TG_DT_2_CFG_1_ADDR A:0x61b080c8
y.create.l HWIO_CAMSS_A_CSID_0_CSID_TG_DT_3_CFG_1_ADDR A:0x61b080d4
y.create.l HWIO_CAMSS_A_CSID_0_CSID_TG_DT_0_CFG_2_ADDR A:0x61b080b4
y.create.l HWIO_CAMSS_A_CSID_0_CSID_TG_DT_1_CFG_2_ADDR A:0x61b080c0
y.create.l HWIO_CAMSS_A_CSID_0_CSID_TG_DT_2_CFG_2_ADDR A:0x61b080cc
y.create.l HWIO_CAMSS_A_CSID_0_CSID_TG_DT_3_CFG_2_ADDR A:0x61b080d8
y.create.l HWIO_CAMSS_A_CSID_0_CSID_SPARE_0_ADDR A:0x61b080dc
y.create.l HWIO_CAMSS_A_CSID_0_CSID_SPARE_1_ADDR A:0x61b080e0
y.create.l HWIO_CAMSS_A_CSID_1_CSID_HW_VERSION_ADDR A:0x61b08400
y.create.l HWIO_CAMSS_A_CSID_1_CSID_CORE_CTRL_0_ADDR A:0x61b08404
y.create.l HWIO_CAMSS_A_CSID_1_CSID_CORE_CTRL_1_ADDR A:0x61b08408
y.create.l HWIO_CAMSS_A_CSID_1_CSID_RST_CMD_ADDR A:0x61b0840c
y.create.l HWIO_CAMSS_A_CSID_1_CSID_CID_LUT_VC_0_ADDR A:0x61b08410
y.create.l HWIO_CAMSS_A_CSID_1_CSID_CID_LUT_VC_1_ADDR A:0x61b08414
y.create.l HWIO_CAMSS_A_CSID_1_CSID_CID_LUT_VC_2_ADDR A:0x61b08418
y.create.l HWIO_CAMSS_A_CSID_1_CSID_CID_LUT_VC_3_ADDR A:0x61b0841c
y.create.l HWIO_CAMSS_A_CSID_1_CSID_CID_0_CFG_ADDR A:0x61b08420
y.create.l HWIO_CAMSS_A_CSID_1_CSID_CID_1_CFG_ADDR A:0x61b08424
y.create.l HWIO_CAMSS_A_CSID_1_CSID_CID_2_CFG_ADDR A:0x61b08428
y.create.l HWIO_CAMSS_A_CSID_1_CSID_CID_3_CFG_ADDR A:0x61b0842c
y.create.l HWIO_CAMSS_A_CSID_1_CSID_CID_4_CFG_ADDR A:0x61b08430
y.create.l HWIO_CAMSS_A_CSID_1_CSID_CID_5_CFG_ADDR A:0x61b08434
y.create.l HWIO_CAMSS_A_CSID_1_CSID_CID_6_CFG_ADDR A:0x61b08438
y.create.l HWIO_CAMSS_A_CSID_1_CSID_CID_7_CFG_ADDR A:0x61b0843c
y.create.l HWIO_CAMSS_A_CSID_1_CSID_CID_8_CFG_ADDR A:0x61b08440
y.create.l HWIO_CAMSS_A_CSID_1_CSID_CID_9_CFG_ADDR A:0x61b08444
y.create.l HWIO_CAMSS_A_CSID_1_CSID_IRQ_CLEAR_CMD_ADDR A:0x61b08460
y.create.l HWIO_CAMSS_A_CSID_1_CSID_IRQ_MASK_ADDR A:0x61b08464
y.create.l HWIO_CAMSS_A_CSID_1_CSID_IRQ_STATUS_ADDR A:0x61b08468
y.create.l HWIO_CAMSS_A_CSID_1_CSID_CAPTURED_UNMAPPED_LONG_PKT_HDR_ADDR A:0x61b0846c
y.create.l HWIO_CAMSS_A_CSID_1_CSID_CAPTURED_MMAPPED_LONG_PKT_HDR_ADDR A:0x61b08470
y.create.l HWIO_CAMSS_A_CSID_1_CSID_CAPTURED_SHORT_PKT_ADDR A:0x61b08474
y.create.l HWIO_CAMSS_A_CSID_1_CSID_CAPTURED_LONG_PKT_HDR_ADDR A:0x61b08478
y.create.l HWIO_CAMSS_A_CSID_1_CSID_CAPTURED_LONG_PKT_FTR_ADDR A:0x61b0847c
y.create.l HWIO_CAMSS_A_CSID_1_CSID_PIF_MISR_DL0_ADDR A:0x61b08480
y.create.l HWIO_CAMSS_A_CSID_1_CSID_PIF_MISR_DL1_ADDR A:0x61b08484
y.create.l HWIO_CAMSS_A_CSID_1_CSID_PIF_MISR_DL2_ADDR A:0x61b08488
y.create.l HWIO_CAMSS_A_CSID_1_CSID_PIF_MISR_DL3_ADDR A:0x61b0848c
y.create.l HWIO_CAMSS_A_CSID_1_CSID_STATS_TOTAL_PKTS_RCVD_ADDR A:0x61b08490
y.create.l HWIO_CAMSS_A_CSID_1_CSID_STATS_ECC_ADDR A:0x61b08494
y.create.l HWIO_CAMSS_A_CSID_1_CSID_STATS_CRC_ADDR A:0x61b08498
y.create.l HWIO_CAMSS_A_CSID_1_CSID_TEST_BUS_CTRL_ADDR A:0x61b0849c
y.create.l HWIO_CAMSS_A_CSID_1_CSID_TG_CTRL_ADDR A:0x61b084a0
y.create.l HWIO_CAMSS_A_CSID_1_CSID_TG_VC_CFG_ADDR A:0x61b084a4
y.create.l HWIO_CAMSS_A_CSID_1_CSID_TG_PAYLOAD_LFSR_SEED_ADDR A:0x61b084a8
y.create.l HWIO_CAMSS_A_CSID_1_CSID_TG_DT_0_CFG_0_ADDR A:0x61b084ac
y.create.l HWIO_CAMSS_A_CSID_1_CSID_TG_DT_1_CFG_0_ADDR A:0x61b084b8
y.create.l HWIO_CAMSS_A_CSID_1_CSID_TG_DT_2_CFG_0_ADDR A:0x61b084c4
y.create.l HWIO_CAMSS_A_CSID_1_CSID_TG_DT_3_CFG_0_ADDR A:0x61b084d0
y.create.l HWIO_CAMSS_A_CSID_1_CSID_TG_DT_0_CFG_1_ADDR A:0x61b084b0
y.create.l HWIO_CAMSS_A_CSID_1_CSID_TG_DT_1_CFG_1_ADDR A:0x61b084bc
y.create.l HWIO_CAMSS_A_CSID_1_CSID_TG_DT_2_CFG_1_ADDR A:0x61b084c8
y.create.l HWIO_CAMSS_A_CSID_1_CSID_TG_DT_3_CFG_1_ADDR A:0x61b084d4
y.create.l HWIO_CAMSS_A_CSID_1_CSID_TG_DT_0_CFG_2_ADDR A:0x61b084b4
y.create.l HWIO_CAMSS_A_CSID_1_CSID_TG_DT_1_CFG_2_ADDR A:0x61b084c0
y.create.l HWIO_CAMSS_A_CSID_1_CSID_TG_DT_2_CFG_2_ADDR A:0x61b084cc
y.create.l HWIO_CAMSS_A_CSID_1_CSID_TG_DT_3_CFG_2_ADDR A:0x61b084d8
y.create.l HWIO_CAMSS_A_CSID_1_CSID_SPARE_0_ADDR A:0x61b084dc
y.create.l HWIO_CAMSS_A_CSID_1_CSID_SPARE_1_ADDR A:0x61b084e0
y.create.l HWIO_CAMSS_A_ISPIF_RST_CMD_0_ADDR A:0x61b0a008
y.create.l HWIO_CAMSS_A_ISPIF_RST_CMD_1_ADDR A:0x61b0a00c
y.create.l HWIO_CAMSS_A_ISPIF_IRQ_GLOBAL_CLEAR_CMD_ADDR A:0x61b0a01c
y.create.l HWIO_CAMSS_A_ISPIF_TEST_BUS_CTRL_ADDR A:0x61b0a020
y.create.l HWIO_CAMSS_A_ISPIF_VFE_0_CTRL_0_ADDR A:0x61b0a200
y.create.l HWIO_CAMSS_A_ISPIF_VFE_0_IRQ_MASK_0_ADDR A:0x61b0a208
y.create.l HWIO_CAMSS_A_ISPIF_VFE_0_IRQ_MASK_1_ADDR A:0x61b0a20c
y.create.l HWIO_CAMSS_A_ISPIF_VFE_0_IRQ_MASK_2_ADDR A:0x61b0a210
y.create.l HWIO_CAMSS_A_ISPIF_VFE_0_IRQ_STATUS_0_ADDR A:0x61b0a21c
y.create.l HWIO_CAMSS_A_ISPIF_VFE_0_IRQ_STATUS_1_ADDR A:0x61b0a220
y.create.l HWIO_CAMSS_A_ISPIF_VFE_0_IRQ_STATUS_2_ADDR A:0x61b0a224
y.create.l HWIO_CAMSS_A_ISPIF_VFE_0_IRQ_CLEAR_0_ADDR A:0x61b0a230
y.create.l HWIO_CAMSS_A_ISPIF_VFE_0_IRQ_CLEAR_1_ADDR A:0x61b0a234
y.create.l HWIO_CAMSS_A_ISPIF_VFE_0_IRQ_CLEAR_2_ADDR A:0x61b0a238
y.create.l HWIO_CAMSS_A_ISPIF_VFE_0_INTF_INPUT_SEL_ADDR A:0x61b0a244
y.create.l HWIO_CAMSS_A_ISPIF_VFE_0_INTF_CMD_0_ADDR A:0x61b0a248
y.create.l HWIO_CAMSS_A_ISPIF_VFE_0_INTF_CMD_1_ADDR A:0x61b0a24c
y.create.l HWIO_CAMSS_A_ISPIF_VFE_0_PIX_INTF_0_CID_MASK_ADDR A:0x61b0a254
y.create.l HWIO_CAMSS_A_ISPIF_VFE_0_PIX_INTF_1_CID_MASK_ADDR A:0x61b0a258
y.create.l HWIO_CAMSS_A_ISPIF_VFE_0_RDI_INTF_0_CID_MASK_ADDR A:0x61b0a264
y.create.l HWIO_CAMSS_A_ISPIF_VFE_0_RDI_INTF_1_CID_MASK_ADDR A:0x61b0a268
y.create.l HWIO_CAMSS_A_ISPIF_VFE_0_RDI_INTF_2_CID_MASK_ADDR A:0x61b0a26c
y.create.l HWIO_CAMSS_A_ISPIF_VFE_0_PIX_INTF_0_CROP_ADDR A:0x61b0a278
y.create.l HWIO_CAMSS_A_ISPIF_VFE_0_PIX_INTF_1_CROP_ADDR A:0x61b0a27c
y.create.l HWIO_CAMSS_A_ISPIF_VFE_0_3D_THRESHOLD_ADDR A:0x61b0a288
y.create.l HWIO_CAMSS_A_ISPIF_VFE_0_OUTPUT_SEL_ADDR A:0x61b0a28c
y.create.l HWIO_CAMSS_A_ISPIF_VFE_0_PIX_OUTPUT_0_MISR_ADDR A:0x61b0a290
y.create.l HWIO_CAMSS_A_ISPIF_VFE_0_RDI_OUTPUT_0_MISR_0_ADDR A:0x61b0a298
y.create.l HWIO_CAMSS_A_ISPIF_VFE_0_RDI_OUTPUT_1_MISR_0_ADDR A:0x61b0a2a0
y.create.l HWIO_CAMSS_A_ISPIF_VFE_0_RDI_OUTPUT_2_MISR_0_ADDR A:0x61b0a2a8
y.create.l HWIO_CAMSS_A_ISPIF_VFE_0_RDI_OUTPUT_0_MISR_1_ADDR A:0x61b0a29c
y.create.l HWIO_CAMSS_A_ISPIF_VFE_0_RDI_OUTPUT_1_MISR_1_ADDR A:0x61b0a2a4
y.create.l HWIO_CAMSS_A_ISPIF_VFE_0_RDI_OUTPUT_2_MISR_1_ADDR A:0x61b0a2ac
y.create.l HWIO_CAMSS_A_ISPIF_VFE_0_PIX_INTF_0_STATUS_ADDR A:0x61b0a2c0
y.create.l HWIO_CAMSS_A_ISPIF_VFE_0_PIX_INTF_1_STATUS_ADDR A:0x61b0a2c4
y.create.l HWIO_CAMSS_A_ISPIF_VFE_0_RDI_INTF_0_STATUS_ADDR A:0x61b0a2d0
y.create.l HWIO_CAMSS_A_ISPIF_VFE_0_RDI_INTF_1_STATUS_ADDR A:0x61b0a2d4
y.create.l HWIO_CAMSS_A_ISPIF_VFE_0_RDI_INTF_2_STATUS_ADDR A:0x61b0a2d8
y.create.l HWIO_CAMSS_A_ISPIF_VFE_0_3D_DESKEW_SIZE_ADDR A:0x61b0a2e4
y.create.l HWIO_CAMSS_A_CSI_PHY_0_MIPI_CSIPHY_LN0_CFG1_ADDR A:0x61b0ac00
y.create.l HWIO_CAMSS_A_CSI_PHY_0_MIPI_CSIPHY_LN1_CFG1_ADDR A:0x61b0ac40
y.create.l HWIO_CAMSS_A_CSI_PHY_0_MIPI_CSIPHY_LN2_CFG1_ADDR A:0x61b0ac80
y.create.l HWIO_CAMSS_A_CSI_PHY_0_MIPI_CSIPHY_LN3_CFG1_ADDR A:0x61b0acc0
y.create.l HWIO_CAMSS_A_CSI_PHY_0_MIPI_CSIPHY_LN4_CFG1_ADDR A:0x61b0ad00
y.create.l HWIO_CAMSS_A_CSI_PHY_0_MIPI_CSIPHY_LN0_CFG2_ADDR A:0x61b0ac04
y.create.l HWIO_CAMSS_A_CSI_PHY_0_MIPI_CSIPHY_LN1_CFG2_ADDR A:0x61b0ac44
y.create.l HWIO_CAMSS_A_CSI_PHY_0_MIPI_CSIPHY_LN2_CFG2_ADDR A:0x61b0ac84
y.create.l HWIO_CAMSS_A_CSI_PHY_0_MIPI_CSIPHY_LN3_CFG2_ADDR A:0x61b0acc4
y.create.l HWIO_CAMSS_A_CSI_PHY_0_MIPI_CSIPHY_LN4_CFG2_ADDR A:0x61b0ad04
y.create.l HWIO_CAMSS_A_CSI_PHY_0_MIPI_CSIPHY_LN0_CFG3_ADDR A:0x61b0ac08
y.create.l HWIO_CAMSS_A_CSI_PHY_0_MIPI_CSIPHY_LN1_CFG3_ADDR A:0x61b0ac48
y.create.l HWIO_CAMSS_A_CSI_PHY_0_MIPI_CSIPHY_LN2_CFG3_ADDR A:0x61b0ac88
y.create.l HWIO_CAMSS_A_CSI_PHY_0_MIPI_CSIPHY_LN3_CFG3_ADDR A:0x61b0acc8
y.create.l HWIO_CAMSS_A_CSI_PHY_0_MIPI_CSIPHY_LN4_CFG3_ADDR A:0x61b0ad08
y.create.l HWIO_CAMSS_A_CSI_PHY_0_MIPI_CSIPHY_LN0_CFG4_ADDR A:0x61b0ac0c
y.create.l HWIO_CAMSS_A_CSI_PHY_0_MIPI_CSIPHY_LN1_CFG4_ADDR A:0x61b0ac4c
y.create.l HWIO_CAMSS_A_CSI_PHY_0_MIPI_CSIPHY_LN2_CFG4_ADDR A:0x61b0ac8c
y.create.l HWIO_CAMSS_A_CSI_PHY_0_MIPI_CSIPHY_LN3_CFG4_ADDR A:0x61b0accc
y.create.l HWIO_CAMSS_A_CSI_PHY_0_MIPI_CSIPHY_LN4_CFG4_ADDR A:0x61b0ad0c
y.create.l HWIO_CAMSS_A_CSI_PHY_0_MIPI_CSIPHY_LN0_CFG5_ADDR A:0x61b0ac10
y.create.l HWIO_CAMSS_A_CSI_PHY_0_MIPI_CSIPHY_LN1_CFG5_ADDR A:0x61b0ac50
y.create.l HWIO_CAMSS_A_CSI_PHY_0_MIPI_CSIPHY_LN2_CFG5_ADDR A:0x61b0ac90
y.create.l HWIO_CAMSS_A_CSI_PHY_0_MIPI_CSIPHY_LN3_CFG5_ADDR A:0x61b0acd0
y.create.l HWIO_CAMSS_A_CSI_PHY_0_MIPI_CSIPHY_LN4_CFG5_ADDR A:0x61b0ad10
y.create.l HWIO_CAMSS_A_CSI_PHY_0_MIPI_CSIPHY_LN0_TEST_FORCE_ADDR A:0x61b0ac14
y.create.l HWIO_CAMSS_A_CSI_PHY_0_MIPI_CSIPHY_LN1_TEST_FORCE_ADDR A:0x61b0ac54
y.create.l HWIO_CAMSS_A_CSI_PHY_0_MIPI_CSIPHY_LN2_TEST_FORCE_ADDR A:0x61b0ac94
y.create.l HWIO_CAMSS_A_CSI_PHY_0_MIPI_CSIPHY_LN3_TEST_FORCE_ADDR A:0x61b0acd4
y.create.l HWIO_CAMSS_A_CSI_PHY_0_MIPI_CSIPHY_LN4_TEST_FORCE_ADDR A:0x61b0ad14
y.create.l HWIO_CAMSS_A_CSI_PHY_0_MIPI_CSIPHY_LN0_TEST_DPATH_ADDR A:0x61b0ac18
y.create.l HWIO_CAMSS_A_CSI_PHY_0_MIPI_CSIPHY_LN1_TEST_DPATH_ADDR A:0x61b0ac58
y.create.l HWIO_CAMSS_A_CSI_PHY_0_MIPI_CSIPHY_LN2_TEST_DPATH_ADDR A:0x61b0ac98
y.create.l HWIO_CAMSS_A_CSI_PHY_0_MIPI_CSIPHY_LN3_TEST_DPATH_ADDR A:0x61b0acd8
y.create.l HWIO_CAMSS_A_CSI_PHY_0_MIPI_CSIPHY_LN4_TEST_DPATH_ADDR A:0x61b0ad18
y.create.l HWIO_CAMSS_A_CSI_PHY_0_MIPI_CSIPHY_LN0_TEST_IMP_ADDR A:0x61b0ac1c
y.create.l HWIO_CAMSS_A_CSI_PHY_0_MIPI_CSIPHY_LN1_TEST_IMP_ADDR A:0x61b0ac5c
y.create.l HWIO_CAMSS_A_CSI_PHY_0_MIPI_CSIPHY_LN2_TEST_IMP_ADDR A:0x61b0ac9c
y.create.l HWIO_CAMSS_A_CSI_PHY_0_MIPI_CSIPHY_LN3_TEST_IMP_ADDR A:0x61b0acdc
y.create.l HWIO_CAMSS_A_CSI_PHY_0_MIPI_CSIPHY_LN4_TEST_IMP_ADDR A:0x61b0ad1c
y.create.l HWIO_CAMSS_A_CSI_PHY_0_MIPI_CSIPHY_LN0_BIST_CTL1_ADDR A:0x61b0ac20
y.create.l HWIO_CAMSS_A_CSI_PHY_0_MIPI_CSIPHY_LN1_BIST_CTL1_ADDR A:0x61b0ac60
y.create.l HWIO_CAMSS_A_CSI_PHY_0_MIPI_CSIPHY_LN2_BIST_CTL1_ADDR A:0x61b0aca0
y.create.l HWIO_CAMSS_A_CSI_PHY_0_MIPI_CSIPHY_LN3_BIST_CTL1_ADDR A:0x61b0ace0
y.create.l HWIO_CAMSS_A_CSI_PHY_0_MIPI_CSIPHY_LN4_BIST_CTL1_ADDR A:0x61b0ad20
y.create.l HWIO_CAMSS_A_CSI_PHY_0_MIPI_CSIPHY_LN0_BIST_CTL2_ADDR A:0x61b0ac24
y.create.l HWIO_CAMSS_A_CSI_PHY_0_MIPI_CSIPHY_LN1_BIST_CTL2_ADDR A:0x61b0ac64
y.create.l HWIO_CAMSS_A_CSI_PHY_0_MIPI_CSIPHY_LN2_BIST_CTL2_ADDR A:0x61b0aca4
y.create.l HWIO_CAMSS_A_CSI_PHY_0_MIPI_CSIPHY_LN3_BIST_CTL2_ADDR A:0x61b0ace4
y.create.l HWIO_CAMSS_A_CSI_PHY_0_MIPI_CSIPHY_LN4_BIST_CTL2_ADDR A:0x61b0ad24
y.create.l HWIO_CAMSS_A_CSI_PHY_0_MIPI_CSIPHY_LN0_MISC1_ADDR A:0x61b0ac28
y.create.l HWIO_CAMSS_A_CSI_PHY_0_MIPI_CSIPHY_LN1_MISC1_ADDR A:0x61b0ac68
y.create.l HWIO_CAMSS_A_CSI_PHY_0_MIPI_CSIPHY_LN2_MISC1_ADDR A:0x61b0aca8
y.create.l HWIO_CAMSS_A_CSI_PHY_0_MIPI_CSIPHY_LN3_MISC1_ADDR A:0x61b0ace8
y.create.l HWIO_CAMSS_A_CSI_PHY_0_MIPI_CSIPHY_LN4_MISC1_ADDR A:0x61b0ad28
y.create.l HWIO_CAMSS_A_CSI_PHY_0_MIPI_CSIPHY_LN0_STATUS_ADDR A:0x61b0ac2c
y.create.l HWIO_CAMSS_A_CSI_PHY_0_MIPI_CSIPHY_LN1_STATUS_ADDR A:0x61b0ac6c
y.create.l HWIO_CAMSS_A_CSI_PHY_0_MIPI_CSIPHY_LN2_STATUS_ADDR A:0x61b0acac
y.create.l HWIO_CAMSS_A_CSI_PHY_0_MIPI_CSIPHY_LN3_STATUS_ADDR A:0x61b0acec
y.create.l HWIO_CAMSS_A_CSI_PHY_0_MIPI_CSIPHY_LN4_STATUS_ADDR A:0x61b0ad2c
y.create.l HWIO_CAMSS_A_CSI_PHY_0_MIPI_CSIPHY_LN0_BIST_MISR_STAT1_ADDR A:0x61b0ac30
y.create.l HWIO_CAMSS_A_CSI_PHY_0_MIPI_CSIPHY_LN1_BIST_MISR_STAT1_ADDR A:0x61b0ac70
y.create.l HWIO_CAMSS_A_CSI_PHY_0_MIPI_CSIPHY_LN2_BIST_MISR_STAT1_ADDR A:0x61b0acb0
y.create.l HWIO_CAMSS_A_CSI_PHY_0_MIPI_CSIPHY_LN3_BIST_MISR_STAT1_ADDR A:0x61b0acf0
y.create.l HWIO_CAMSS_A_CSI_PHY_0_MIPI_CSIPHY_LN4_BIST_MISR_STAT1_ADDR A:0x61b0ad30
y.create.l HWIO_CAMSS_A_CSI_PHY_0_MIPI_CSIPHY_LN0_BIST_MISR_STAT2_ADDR A:0x61b0ac34
y.create.l HWIO_CAMSS_A_CSI_PHY_0_MIPI_CSIPHY_LN1_BIST_MISR_STAT2_ADDR A:0x61b0ac74
y.create.l HWIO_CAMSS_A_CSI_PHY_0_MIPI_CSIPHY_LN2_BIST_MISR_STAT2_ADDR A:0x61b0acb4
y.create.l HWIO_CAMSS_A_CSI_PHY_0_MIPI_CSIPHY_LN3_BIST_MISR_STAT2_ADDR A:0x61b0acf4
y.create.l HWIO_CAMSS_A_CSI_PHY_0_MIPI_CSIPHY_LN4_BIST_MISR_STAT2_ADDR A:0x61b0ad34
y.create.l HWIO_CAMSS_A_CSI_PHY_0_MIPI_CSIPHY_LN0_MISR_STAT3_ADDR A:0x61b0ac38
y.create.l HWIO_CAMSS_A_CSI_PHY_0_MIPI_CSIPHY_LN1_MISR_STAT3_ADDR A:0x61b0ac78
y.create.l HWIO_CAMSS_A_CSI_PHY_0_MIPI_CSIPHY_LN2_MISR_STAT3_ADDR A:0x61b0acb8
y.create.l HWIO_CAMSS_A_CSI_PHY_0_MIPI_CSIPHY_LN3_MISR_STAT3_ADDR A:0x61b0acf8
y.create.l HWIO_CAMSS_A_CSI_PHY_0_MIPI_CSIPHY_LN4_MISR_STAT3_ADDR A:0x61b0ad38
y.create.l HWIO_CAMSS_A_CSI_PHY_0_MIPI_CSIPHY_LN0_MISR_STAT4_ADDR A:0x61b0ac3c
y.create.l HWIO_CAMSS_A_CSI_PHY_0_MIPI_CSIPHY_LN1_MISR_STAT4_ADDR A:0x61b0ac7c
y.create.l HWIO_CAMSS_A_CSI_PHY_0_MIPI_CSIPHY_LN2_MISR_STAT4_ADDR A:0x61b0acbc
y.create.l HWIO_CAMSS_A_CSI_PHY_0_MIPI_CSIPHY_LN3_MISR_STAT4_ADDR A:0x61b0acfc
y.create.l HWIO_CAMSS_A_CSI_PHY_0_MIPI_CSIPHY_LN4_MISR_STAT4_ADDR A:0x61b0ad3c
y.create.l HWIO_CAMSS_A_CSI_PHY_0_MIPI_CSIPHY_GLBL_RESET_ADDR A:0x61b0ad40
y.create.l HWIO_CAMSS_A_CSI_PHY_0_MIPI_CSIPHY_GLBL_PWR_CFG_ADDR A:0x61b0ad44
y.create.l HWIO_CAMSS_A_CSI_PHY_0_MIPI_CSIPHY_GLBL_TEST_FORCE_ADDR A:0x61b0ad48
y.create.l HWIO_CAMSS_A_CSI_PHY_0_MIPI_CSIPHY_GLBL_TEST_IMP_ADDR A:0x61b0ad4c
y.create.l HWIO_CAMSS_A_CSI_PHY_0_MIPI_CSIPHY_GLBL_BIST_CFG1_ADDR A:0x61b0ad50
y.create.l HWIO_CAMSS_A_CSI_PHY_0_MIPI_CSIPHY_GLBL_BIST_CFG2_ADDR A:0x61b0ad54
y.create.l HWIO_CAMSS_A_CSI_PHY_0_MIPI_CSIPHY_GLBL_BIST_CFG3_ADDR A:0x61b0ad58
y.create.l HWIO_CAMSS_A_CSI_PHY_0_MIPI_CSIPHY_GLBL_BIST_CFG4_ADDR A:0x61b0ad5c
y.create.l HWIO_CAMSS_A_CSI_PHY_0_MIPI_CSIPHY_GLBL_MISR_CFG_ADDR A:0x61b0ad60
y.create.l HWIO_CAMSS_A_CSI_PHY_0_MIPI_CSIPHY_GLBL_IRQ_CMD_ADDR A:0x61b0ad64
y.create.l HWIO_CAMSS_A_CSI_PHY_0_MIPI_CSIPHY_GLBL_STATUS1_ADDR A:0x61b0ad68
y.create.l HWIO_CAMSS_A_CSI_PHY_0_MIPI_CSIPHY_DEBUG_BUS0_ADDR A:0x61b0ad6c
y.create.l HWIO_CAMSS_A_CSI_PHY_0_MIPI_CSIPHY_DEBUG_BUS1_ADDR A:0x61b0ad70
y.create.l HWIO_CAMSS_A_CSI_PHY_0_MIPI_CSIPHY_DEBUG_BUS2_ADDR A:0x61b0ad74
y.create.l HWIO_CAMSS_A_CSI_PHY_0_MIPI_CSIPHY_DEBUG_BUS3_ADDR A:0x61b0ad78
y.create.l HWIO_CAMSS_A_CSI_PHY_0_MIPI_CSIPHY_REVISION_ID0_ADDR A:0x61b0ad7c
y.create.l HWIO_CAMSS_A_CSI_PHY_0_MIPI_CSIPHY_REVISION_ID1_ADDR A:0x61b0ad80
y.create.l HWIO_CAMSS_A_CSI_PHY_0_MIPI_CSIPHY_REVISION_ID2_ADDR A:0x61b0ad84
y.create.l HWIO_CAMSS_A_CSI_PHY_0_MIPI_CSIPHY_REVISION_ID3_ADDR A:0x61b0ad88
y.create.l HWIO_CAMSS_A_CSI_PHY_0_MIPI_CSIPHY_INTERRUPT_STATUS0_ADDR A:0x61b0ad8c
y.create.l HWIO_CAMSS_A_CSI_PHY_0_MIPI_CSIPHY_INTERRUPT_STATUS1_ADDR A:0x61b0ad90
y.create.l HWIO_CAMSS_A_CSI_PHY_0_MIPI_CSIPHY_INTERRUPT_STATUS2_ADDR A:0x61b0ad94
y.create.l HWIO_CAMSS_A_CSI_PHY_0_MIPI_CSIPHY_INTERRUPT_STATUS3_ADDR A:0x61b0ad98
y.create.l HWIO_CAMSS_A_CSI_PHY_0_MIPI_CSIPHY_INTERRUPT_STATUS4_ADDR A:0x61b0ad9c
y.create.l HWIO_CAMSS_A_CSI_PHY_0_MIPI_CSIPHY_INTERRUPT_STATUS5_ADDR A:0x61b0ada0
y.create.l HWIO_CAMSS_A_CSI_PHY_0_MIPI_CSIPHY_INTERRUPT_STATUS6_ADDR A:0x61b0ada4
y.create.l HWIO_CAMSS_A_CSI_PHY_0_MIPI_CSIPHY_INTERRUPT_STATUS7_ADDR A:0x61b0ada8
y.create.l HWIO_CAMSS_A_CSI_PHY_0_MIPI_CSIPHY_INTERRUPT_MASK0_ADDR A:0x61b0adac
y.create.l HWIO_CAMSS_A_CSI_PHY_0_MIPI_CSIPHY_INTERRUPT_MASK1_ADDR A:0x61b0adb0
y.create.l HWIO_CAMSS_A_CSI_PHY_0_MIPI_CSIPHY_INTERRUPT_MASK2_ADDR A:0x61b0adb4
y.create.l HWIO_CAMSS_A_CSI_PHY_0_MIPI_CSIPHY_INTERRUPT_MASK3_ADDR A:0x61b0adb8
y.create.l HWIO_CAMSS_A_CSI_PHY_0_MIPI_CSIPHY_INTERRUPT_MASK4_ADDR A:0x61b0adbc
y.create.l HWIO_CAMSS_A_CSI_PHY_0_MIPI_CSIPHY_INTERRUPT_MASK5_ADDR A:0x61b0adc0
y.create.l HWIO_CAMSS_A_CSI_PHY_0_MIPI_CSIPHY_INTERRUPT_MASK6_ADDR A:0x61b0adc4
y.create.l HWIO_CAMSS_A_CSI_PHY_0_MIPI_CSIPHY_INTERRUPT_MASK7_ADDR A:0x61b0adc8
y.create.l HWIO_CAMSS_A_CSI_PHY_0_MIPI_CSIPHY_INTERRUPT_CLEAR0_ADDR A:0x61b0adcc
y.create.l HWIO_CAMSS_A_CSI_PHY_0_MIPI_CSIPHY_INTERRUPT_CLEAR1_ADDR A:0x61b0add0
y.create.l HWIO_CAMSS_A_CSI_PHY_0_MIPI_CSIPHY_INTERRUPT_CLEAR2_ADDR A:0x61b0add4
y.create.l HWIO_CAMSS_A_CSI_PHY_0_MIPI_CSIPHY_INTERRUPT_CLEAR3_ADDR A:0x61b0add8
y.create.l HWIO_CAMSS_A_CSI_PHY_0_MIPI_CSIPHY_INTERRUPT_CLEAR4_ADDR A:0x61b0addc
y.create.l HWIO_CAMSS_A_CSI_PHY_0_MIPI_CSIPHY_INTERRUPT_CLEAR5_ADDR A:0x61b0ade0
y.create.l HWIO_CAMSS_A_CSI_PHY_0_MIPI_CSIPHY_INTERRUPT_CLEAR6_ADDR A:0x61b0ade4
y.create.l HWIO_CAMSS_A_CSI_PHY_0_MIPI_CSIPHY_INTERRUPT_CLEAR7_ADDR A:0x61b0ade8
y.create.l HWIO_CAMSS_A_CSI_PHY_0_MIPI_CSIPHY_GLBL_T_INIT_CFG0_ADDR A:0x61b0adec
y.create.l HWIO_CAMSS_A_CSI_PHY_0_MIPI_CSIPHY_GLBL_T_INIT_CFG1_ADDR A:0x61b0adf0
y.create.l HWIO_CAMSS_A_CSI_PHY_0_MIPI_CSIPHY_T_WAKEUP_CFG0_ADDR A:0x61b0adf4
y.create.l HWIO_CAMSS_A_CSI_PHY_0_MIPI_CSIPHY_T_WAKEUP_CFG1_ADDR A:0x61b0adf8
y.create.l HWIO_CAMSS_A_CSI_PHY_0_MIPI_CSIPHY_GLBL_PWG_CFG0_ADDR A:0x61b0adfc
y.create.l HWIO_CAMSS_A_VFE_0_A_VFE_HW_VERSION_ADDR A:0x61b10000
y.create.l HWIO_CAMSS_A_VFE_0_A_VFE_GLOBAL_RESET_CMD_ADDR A:0x61b10004
y.create.l HWIO_CAMSS_A_VFE_0_A_VFE_MODULE_RESET_ADDR A:0x61b10008
y.create.l HWIO_CAMSS_A_VFE_0_A_VFE_CGC_OVERRIDE_ADDR A:0x61b1000c
y.create.l HWIO_CAMSS_A_VFE_0_A_VFE_CGC_OVERRIDE_1_ADDR A:0x61b107b8
y.create.l HWIO_CAMSS_A_VFE_0_A_VFE_MODULE_CFG_ADDR A:0x61b10010
y.create.l HWIO_CAMSS_A_VFE_0_A_VFE_CFG_ADDR A:0x61b10014
y.create.l HWIO_CAMSS_A_VFE_0_A_VFE_3D_CFG_ADDR A:0x61b10738
y.create.l HWIO_CAMSS_A_VFE_0_A_VFE_3D_POST_SCALE_CFG_ADDR A:0x61b1073c
y.create.l HWIO_CAMSS_A_VFE_0_A_VFE_IRQ_CMD_ADDR A:0x61b10018
y.create.l HWIO_CAMSS_A_VFE_0_A_VFE_IRQ_MASK_0_ADDR A:0x61b1001c
y.create.l HWIO_CAMSS_A_VFE_0_A_VFE_IRQ_MASK_1_ADDR A:0x61b10020
y.create.l HWIO_CAMSS_A_VFE_0_A_VFE_IRQ_CLEAR_0_ADDR A:0x61b10024
y.create.l HWIO_CAMSS_A_VFE_0_A_VFE_IRQ_CLEAR_1_ADDR A:0x61b10028
y.create.l HWIO_CAMSS_A_VFE_0_A_VFE_IRQ_STATUS_0_ADDR A:0x61b1002c
y.create.l HWIO_CAMSS_A_VFE_0_A_VFE_IRQ_STATUS_1_ADDR A:0x61b10030
y.create.l HWIO_CAMSS_A_VFE_0_A_VFE_IRQ_COMPOSITE_MASK_ADDR A:0x61b10034
y.create.l HWIO_CAMSS_A_VFE_0_A_VFE_VIOLATION_STATUS_ADDR A:0x61b107b4
y.create.l HWIO_CAMSS_A_VFE_0_A_VFE_BUS_CMD_ADDR A:0x61b10038
y.create.l HWIO_CAMSS_A_VFE_0_A_VFE_BUS_CFG_ADDR A:0x61b1003c
y.create.l HWIO_CAMSS_A_VFE_0_A_VFE_BUS_IO_FORMAT_CFG_ADDR A:0x61b106f8
y.create.l HWIO_CAMSS_A_VFE_0_A_VFE_BUS_XBAR_CFG_0_ADDR A:0x61b10040
y.create.l HWIO_CAMSS_A_VFE_0_A_VFE_BUS_XBAR_CFG_1_ADDR A:0x61b10044
y.create.l HWIO_CAMSS_A_VFE_0_A_VFE_BUS_WR_SKIP_CFG_ADDR A:0x61b10048
y.create.l HWIO_CAMSS_A_VFE_0_A_VFE_BUS_IMAGE_MASTER_0_WR_CFG_ADDR A:0x61b1004c
y.create.l HWIO_CAMSS_A_VFE_0_A_VFE_BUS_IMAGE_MASTER_0_WR_PING_ADDR_ADDR A:0x61b10050
y.create.l HWIO_CAMSS_A_VFE_0_A_VFE_BUS_IMAGE_MASTER_0_WR_PONG_ADDR_ADDR A:0x61b10054
y.create.l HWIO_CAMSS_A_VFE_0_A_VFE_BUS_IMAGE_MASTER_0_WR_UB_CFG_ADDR A:0x61b10058
y.create.l HWIO_CAMSS_A_VFE_0_A_VFE_BUS_IMAGE_MASTER_0_WR_IMAGE_SIZE_ADDR A:0x61b1005c
y.create.l HWIO_CAMSS_A_VFE_0_A_VFE_BUS_IMAGE_MASTER_0_WR_BUFFER_CFG_ADDR A:0x61b10060
y.create.l HWIO_CAMSS_A_VFE_0_A_VFE_BUS_IMAGE_MASTER_1_WR_CFG_ADDR A:0x61b10064
y.create.l HWIO_CAMSS_A_VFE_0_A_VFE_BUS_IMAGE_MASTER_1_WR_PING_ADDR_ADDR A:0x61b10068
y.create.l HWIO_CAMSS_A_VFE_0_A_VFE_BUS_IMAGE_MASTER_1_WR_PONG_ADDR_ADDR A:0x61b1006c
y.create.l HWIO_CAMSS_A_VFE_0_A_VFE_BUS_IMAGE_MASTER_1_WR_UB_CFG_ADDR A:0x61b10070
y.create.l HWIO_CAMSS_A_VFE_0_A_VFE_BUS_IMAGE_MASTER_1_WR_IMAGE_SIZE_ADDR A:0x61b10074
y.create.l HWIO_CAMSS_A_VFE_0_A_VFE_BUS_IMAGE_MASTER_1_WR_BUFFER_CFG_ADDR A:0x61b10078
y.create.l HWIO_CAMSS_A_VFE_0_A_VFE_BUS_IMAGE_MASTER_2_WR_CFG_ADDR A:0x61b1007c
y.create.l HWIO_CAMSS_A_VFE_0_A_VFE_BUS_IMAGE_MASTER_2_WR_PING_ADDR_ADDR A:0x61b10080
y.create.l HWIO_CAMSS_A_VFE_0_A_VFE_BUS_IMAGE_MASTER_2_WR_PONG_ADDR_ADDR A:0x61b10084
y.create.l HWIO_CAMSS_A_VFE_0_A_VFE_BUS_IMAGE_MASTER_2_WR_UB_CFG_ADDR A:0x61b10088
y.create.l HWIO_CAMSS_A_VFE_0_A_VFE_BUS_IMAGE_MASTER_2_WR_IMAGE_SIZE_ADDR A:0x61b1008c
y.create.l HWIO_CAMSS_A_VFE_0_A_VFE_BUS_IMAGE_MASTER_2_WR_BUFFER_CFG_ADDR A:0x61b10090
y.create.l HWIO_CAMSS_A_VFE_0_A_VFE_BUS_IMAGE_MASTER_3_WR_CFG_ADDR A:0x61b10094
y.create.l HWIO_CAMSS_A_VFE_0_A_VFE_BUS_IMAGE_MASTER_3_WR_PING_ADDR_ADDR A:0x61b10098
y.create.l HWIO_CAMSS_A_VFE_0_A_VFE_BUS_IMAGE_MASTER_3_WR_PONG_ADDR_ADDR A:0x61b1009c
y.create.l HWIO_CAMSS_A_VFE_0_A_VFE_BUS_IMAGE_MASTER_3_WR_UB_CFG_ADDR A:0x61b100a0
y.create.l HWIO_CAMSS_A_VFE_0_A_VFE_BUS_IMAGE_MASTER_3_WR_IMAGE_SIZE_ADDR A:0x61b100a4
y.create.l HWIO_CAMSS_A_VFE_0_A_VFE_BUS_IMAGE_MASTER_3_WR_BUFFER_CFG_ADDR A:0x61b100a8
y.create.l HWIO_CAMSS_A_VFE_0_A_VFE_BUS_IMAGE_MASTER_4_WR_CFG_ADDR A:0x61b100ac
y.create.l HWIO_CAMSS_A_VFE_0_A_VFE_BUS_IMAGE_MASTER_4_WR_PING_ADDR_ADDR A:0x61b100b0
y.create.l HWIO_CAMSS_A_VFE_0_A_VFE_BUS_IMAGE_MASTER_4_WR_PONG_ADDR_ADDR A:0x61b100b4
y.create.l HWIO_CAMSS_A_VFE_0_A_VFE_BUS_IMAGE_MASTER_4_WR_UB_CFG_ADDR A:0x61b100b8
y.create.l HWIO_CAMSS_A_VFE_0_A_VFE_BUS_IMAGE_MASTER_4_WR_IMAGE_SIZE_ADDR A:0x61b100bc
y.create.l HWIO_CAMSS_A_VFE_0_A_VFE_BUS_IMAGE_MASTER_4_WR_BUFFER_CFG_ADDR A:0x61b100c0
y.create.l HWIO_CAMSS_A_VFE_0_A_VFE_BUS_IMAGE_MASTER_5_WR_CFG_ADDR A:0x61b100c4
y.create.l HWIO_CAMSS_A_VFE_0_A_VFE_BUS_IMAGE_MASTER_5_WR_PING_ADDR_ADDR A:0x61b100c8
y.create.l HWIO_CAMSS_A_VFE_0_A_VFE_BUS_IMAGE_MASTER_5_WR_PONG_ADDR_ADDR A:0x61b100cc
y.create.l HWIO_CAMSS_A_VFE_0_A_VFE_BUS_IMAGE_MASTER_5_WR_UB_CFG_ADDR A:0x61b100d0
y.create.l HWIO_CAMSS_A_VFE_0_A_VFE_BUS_IMAGE_MASTER_5_WR_IMAGE_SIZE_ADDR A:0x61b100d4
y.create.l HWIO_CAMSS_A_VFE_0_A_VFE_BUS_IMAGE_MASTER_5_WR_BUFFER_CFG_ADDR A:0x61b100d8
y.create.l HWIO_CAMSS_A_VFE_0_A_VFE_BUS_IMAGE_MASTER_6_WR_CFG_ADDR A:0x61b100dc
y.create.l HWIO_CAMSS_A_VFE_0_A_VFE_BUS_IMAGE_MASTER_6_WR_PING_ADDR_ADDR A:0x61b100e0
y.create.l HWIO_CAMSS_A_VFE_0_A_VFE_BUS_IMAGE_MASTER_6_WR_PONG_ADDR_ADDR A:0x61b100e4
y.create.l HWIO_CAMSS_A_VFE_0_A_VFE_BUS_IMAGE_MASTER_6_WR_UB_CFG_ADDR A:0x61b100e8
y.create.l HWIO_CAMSS_A_VFE_0_A_VFE_BUS_IMAGE_MASTER_6_WR_IMAGE_SIZE_ADDR A:0x61b100ec
y.create.l HWIO_CAMSS_A_VFE_0_A_VFE_BUS_IMAGE_MASTER_6_WR_BUFFER_CFG_ADDR A:0x61b100f0
y.create.l HWIO_CAMSS_A_VFE_0_A_VFE_BUS_STATS_AE_BG_WR_PING_ADDR_ADDR A:0x61b100f4
y.create.l HWIO_CAMSS_A_VFE_0_A_VFE_BUS_STATS_AE_BG_WR_PONG_ADDR_ADDR A:0x61b100f8
y.create.l HWIO_CAMSS_A_VFE_0_A_VFE_BUS_STATS_AE_BG_WR_UB_CFG_ADDR A:0x61b100fc
y.create.l HWIO_CAMSS_A_VFE_0_A_VFE_BUS_STATS_AF_BF_WR_PING_ADDR_ADDR A:0x61b10100
y.create.l HWIO_CAMSS_A_VFE_0_A_VFE_BUS_STATS_AF_BF_WR_PONG_ADDR_ADDR A:0x61b10104
y.create.l HWIO_CAMSS_A_VFE_0_A_VFE_BUS_STATS_AF_BF_WR_UB_CFG_ADDR A:0x61b10108
y.create.l HWIO_CAMSS_A_VFE_0_A_VFE_BUS_STATS_AWB_WR_PING_ADDR_ADDR A:0x61b1010c
y.create.l HWIO_CAMSS_A_VFE_0_A_VFE_BUS_STATS_AWB_WR_PONG_ADDR_ADDR A:0x61b10110
y.create.l HWIO_CAMSS_A_VFE_0_A_VFE_BUS_STATS_AWB_WR_UB_CFG_ADDR A:0x61b10114
y.create.l HWIO_CAMSS_A_VFE_0_A_VFE_BUS_STATS_RS_WR_PING_ADDR_ADDR A:0x61b10118
y.create.l HWIO_CAMSS_A_VFE_0_A_VFE_BUS_STATS_RS_WR_PONG_ADDR_ADDR A:0x61b1011c
y.create.l HWIO_CAMSS_A_VFE_0_A_VFE_BUS_STATS_RS_WR_UB_CFG_ADDR A:0x61b10120
y.create.l HWIO_CAMSS_A_VFE_0_A_VFE_BUS_STATS_CS_WR_PING_ADDR_ADDR A:0x61b10124
y.create.l HWIO_CAMSS_A_VFE_0_A_VFE_BUS_STATS_CS_WR_PONG_ADDR_ADDR A:0x61b10128
y.create.l HWIO_CAMSS_A_VFE_0_A_VFE_BUS_STATS_CS_WR_UB_CFG_ADDR A:0x61b1012c
y.create.l HWIO_CAMSS_A_VFE_0_A_VFE_BUS_STATS_IHIST_WR_PING_ADDR_ADDR A:0x61b10130
y.create.l HWIO_CAMSS_A_VFE_0_A_VFE_BUS_STATS_IHIST_WR_PONG_ADDR_ADDR A:0x61b10134
y.create.l HWIO_CAMSS_A_VFE_0_A_VFE_BUS_STATS_IHIST_WR_UB_CFG_ADDR A:0x61b10138
y.create.l HWIO_CAMSS_A_VFE_0_A_VFE_BUS_STATS_SKIN_BHIST_WR_PING_ADDR_ADDR A:0x61b1013c
y.create.l HWIO_CAMSS_A_VFE_0_A_VFE_BUS_STATS_SKIN_BHIST_WR_PONG_ADDR_ADDR A:0x61b10140
y.create.l HWIO_CAMSS_A_VFE_0_A_VFE_BUS_STATS_SKIN_BHIST_WR_UB_CFG_ADDR A:0x61b10144
y.create.l HWIO_CAMSS_A_VFE_0_A_VFE_BUS_STRIPE_RD_ADDR_0_ADDR A:0x61b10148
y.create.l HWIO_CAMSS_A_VFE_0_A_VFE_BUS_STRIPE_RD_ADDR_1_ADDR A:0x61b1014c
y.create.l HWIO_CAMSS_A_VFE_0_A_VFE_BUS_STRIPE_RD_ADDR_2_ADDR A:0x61b10150
y.create.l HWIO_CAMSS_A_VFE_0_A_VFE_BUS_STRIPE_RD_ADDR_3_ADDR A:0x61b10154
y.create.l HWIO_CAMSS_A_VFE_0_A_VFE_BUS_STRIPE_RD_VSIZE_ADDR A:0x61b10158
y.create.l HWIO_CAMSS_A_VFE_0_A_VFE_BUS_STRIPE_RD_HSIZE_ADDR A:0x61b1015c
y.create.l HWIO_CAMSS_A_VFE_0_A_VFE_BUS_STRIPE_RD_BUFFER_CFG_ADDR A:0x61b10160
y.create.l HWIO_CAMSS_A_VFE_0_A_VFE_BUS_STRIPE_RD_UNPACK_CFG_ADDR A:0x61b10164
y.create.l HWIO_CAMSS_A_VFE_0_A_VFE_BUS_STRIPE_RD_UNPACK_ADDR A:0x61b10168
y.create.l HWIO_CAMSS_A_VFE_0_A_VFE_BUS_STRIPE_RD_PAD_SIZE_ADDR A:0x61b1016c
y.create.l HWIO_CAMSS_A_VFE_0_A_VFE_BUS_STRIPE_RD_PAD_L_UNPACK_ADDR A:0x61b10170
y.create.l HWIO_CAMSS_A_VFE_0_A_VFE_BUS_STRIPE_RD_PAD_R_UNPACK_ADDR A:0x61b10174
y.create.l HWIO_CAMSS_A_VFE_0_A_VFE_BUS_STRIPE_RD_PAD_TB_UNPACK_ADDR A:0x61b10178
y.create.l HWIO_CAMSS_A_VFE_0_A_VFE_BUS_STRIPE_RD_CROP_WIDTH_CFG_ADDR A:0x61b1072c
y.create.l HWIO_CAMSS_A_VFE_0_A_VFE_BUS_STRIPE_RD_CROP_HEIGHT_CFG_ADDR A:0x61b10730
y.create.l HWIO_CAMSS_A_VFE_0_A_VFE_BUS_PING_PONG_IRQ_EN_ADDR A:0x61b1017c
y.create.l HWIO_CAMSS_A_VFE_0_A_VFE_BUS_PING_PONG_STATUS_ADDR A:0x61b10180
y.create.l HWIO_CAMSS_A_VFE_0_A_VFE_BUS_OPERATION_STATUS_ADDR A:0x61b10184
y.create.l HWIO_CAMSS_A_VFE_0_A_VFE_BUS_PM_CMD_ADDR A:0x61b10188
y.create.l HWIO_CAMSS_A_VFE_0_A_VFE_BUS_PM_CFG_ADDR A:0x61b1018c
y.create.l HWIO_CAMSS_A_VFE_0_A_VFE_BUS_IMAGE_MASTER_0_WR_PM_STATS_0_ADDR A:0x61b10190
y.create.l HWIO_CAMSS_A_VFE_0_A_VFE_BUS_IMAGE_MASTER_0_WR_PM_STATS_1_ADDR A:0x61b10194
y.create.l HWIO_CAMSS_A_VFE_0_A_VFE_BUS_IMAGE_MASTER_1_WR_PM_STATS_0_ADDR A:0x61b10198
y.create.l HWIO_CAMSS_A_VFE_0_A_VFE_BUS_IMAGE_MASTER_1_WR_PM_STATS_1_ADDR A:0x61b1019c
y.create.l HWIO_CAMSS_A_VFE_0_A_VFE_BUS_IMAGE_MASTER_2_WR_PM_STATS_0_ADDR A:0x61b101a0
y.create.l HWIO_CAMSS_A_VFE_0_A_VFE_BUS_IMAGE_MASTER_2_WR_PM_STATS_1_ADDR A:0x61b101a4
y.create.l HWIO_CAMSS_A_VFE_0_A_VFE_BUS_IMAGE_MASTER_3_WR_PM_STATS_0_ADDR A:0x61b101a8
y.create.l HWIO_CAMSS_A_VFE_0_A_VFE_BUS_IMAGE_MASTER_3_WR_PM_STATS_1_ADDR A:0x61b101ac
y.create.l HWIO_CAMSS_A_VFE_0_A_VFE_BUS_IMAGE_MASTER_4_WR_PM_STATS_0_ADDR A:0x61b101b0
y.create.l HWIO_CAMSS_A_VFE_0_A_VFE_BUS_IMAGE_MASTER_4_WR_PM_STATS_1_ADDR A:0x61b101b4
y.create.l HWIO_CAMSS_A_VFE_0_A_VFE_BUS_IMAGE_MASTER_5_WR_PM_STATS_0_ADDR A:0x61b101b8
y.create.l HWIO_CAMSS_A_VFE_0_A_VFE_BUS_IMAGE_MASTER_5_WR_PM_STATS_1_ADDR A:0x61b101bc
y.create.l HWIO_CAMSS_A_VFE_0_A_VFE_BUS_IMAGE_MASTER_6_WR_PM_STATS_0_ADDR A:0x61b101c0
y.create.l HWIO_CAMSS_A_VFE_0_A_VFE_BUS_IMAGE_MASTER_6_WR_PM_STATS_1_ADDR A:0x61b101c4
y.create.l HWIO_CAMSS_A_VFE_0_A_VFE_BUS_MISR_CFG_ADDR A:0x61b101c8
y.create.l HWIO_CAMSS_A_VFE_0_A_VFE_BUS_MISR_MAST_CFG_0_ADDR A:0x61b101cc
y.create.l HWIO_CAMSS_A_VFE_0_A_VFE_BUS_MISR_MAST_CFG_1_ADDR A:0x61b101d0
y.create.l HWIO_CAMSS_A_VFE_0_A_VFE_BUS_MISR_RD_VAL_ADDR A:0x61b101d4
y.create.l HWIO_CAMSS_A_VFE_0_A_VFE_AXI_CMD_ADDR A:0x61b101d8
y.create.l HWIO_CAMSS_A_VFE_0_A_VFE_AXI_CFG_ADDR A:0x61b10600
y.create.l HWIO_CAMSS_A_VFE_0_A_VFE_AXI_STATUS_ADDR A:0x61b101dc
y.create.l HWIO_CAMSS_A_VFE_0_A_VFE_BUS_BDG_QOS_CFG_0_ADDR A:0x61b107bc
y.create.l HWIO_CAMSS_A_VFE_0_A_VFE_BUS_BDG_QOS_CFG_1_ADDR A:0x61b107c0
y.create.l HWIO_CAMSS_A_VFE_0_A_VFE_BUS_BDG_QOS_CFG_2_ADDR A:0x61b107c4
y.create.l HWIO_CAMSS_A_VFE_0_A_VFE_BUS_BDG_QOS_CFG_3_ADDR A:0x61b107c8
y.create.l HWIO_CAMSS_A_VFE_0_A_VFE_BUS_BDG_QOS_CFG_4_ADDR A:0x61b107cc
y.create.l HWIO_CAMSS_A_VFE_0_A_VFE_BUS_BDG_QOS_CFG_5_ADDR A:0x61b107d0
y.create.l HWIO_CAMSS_A_VFE_0_A_VFE_BUS_BDG_QOS_CFG_6_ADDR A:0x61b107d4
y.create.l HWIO_CAMSS_A_VFE_0_A_VFE_BUS_BDG_QOS_CFG_7_ADDR A:0x61b10798
y.create.l HWIO_CAMSS_A_VFE_0_A_VFE_BUS_BDG_DS_CFG_0_ADDR A:0x61b107d8
y.create.l HWIO_CAMSS_A_VFE_0_A_VFE_BUS_BDG_DS_CFG_1_ADDR A:0x61b107dc
y.create.l HWIO_CAMSS_A_VFE_0_A_VFE_BUS_BDG_DS_CFG_2_ADDR A:0x61b107e0
y.create.l HWIO_CAMSS_A_VFE_0_A_VFE_BUS_BDG_DS_CFG_3_ADDR A:0x61b107e4
y.create.l HWIO_CAMSS_A_VFE_0_A_VFE_BUS_BDG_DS_CFG_4_ADDR A:0x61b107e8
y.create.l HWIO_CAMSS_A_VFE_0_A_VFE_BUS_BDG_DS_CFG_5_ADDR A:0x61b107ec
y.create.l HWIO_CAMSS_A_VFE_0_A_VFE_BUS_BDG_DS_CFG_6_ADDR A:0x61b107f0
y.create.l HWIO_CAMSS_A_VFE_0_A_VFE_BUS_BDG_DS_CFG_7_ADDR A:0x61b107f4
y.create.l HWIO_CAMSS_A_VFE_0_A_VFE_BUS_BDG_DS_CFG_8_ADDR A:0x61b107f8
y.create.l HWIO_CAMSS_A_VFE_0_A_VFE_BUS_BDG_DS_CFG_9_ADDR A:0x61b107fc
y.create.l HWIO_CAMSS_A_VFE_0_A_VFE_BUS_BDG_DS_CFG_10_ADDR A:0x61b10800
y.create.l HWIO_CAMSS_A_VFE_0_A_VFE_BUS_BDG_DS_CFG_11_ADDR A:0x61b10804
y.create.l HWIO_CAMSS_A_VFE_0_A_VFE_BUS_BDG_DS_CFG_12_ADDR A:0x61b10808
y.create.l HWIO_CAMSS_A_VFE_0_A_VFE_BUS_BDG_DS_CFG_13_ADDR A:0x61b1080c
y.create.l HWIO_CAMSS_A_VFE_0_A_VFE_BUS_BDG_DS_CFG_16_ADDR A:0x61b10810
y.create.l HWIO_CAMSS_A_VFE_0_A_VFE_PIXEL_IF_CFG_ADDR A:0x61b106fc
y.create.l HWIO_CAMSS_A_VFE_0_A_VFE_RDI_CFG_0_ADDR A:0x61b10734
y.create.l HWIO_CAMSS_A_VFE_0_A_VFE_RDI_CFG_1_ADDR A:0x61b107a4
y.create.l HWIO_CAMSS_A_VFE_0_A_CAMIF_CMD_ADDR A:0x61b101e0
y.create.l HWIO_CAMSS_A_VFE_0_A_CAMIF_CFG_ADDR A:0x61b101e4
y.create.l HWIO_CAMSS_A_VFE_0_A_CAMIF_EFS_CFG_ADDR A:0x61b101e8
y.create.l HWIO_CAMSS_A_VFE_0_A_CAMIF_FRAME_CFG_ADDR A:0x61b101ec
y.create.l HWIO_CAMSS_A_VFE_0_A_CAMIF_WINDOW_WIDTH_CFG_ADDR A:0x61b101f0
y.create.l HWIO_CAMSS_A_VFE_0_A_CAMIF_WINDOW_HEIGHT_CFG_ADDR A:0x61b101f4
y.create.l HWIO_CAMSS_A_VFE_0_A_CAMIF_SUBSAMPLE_CFG_1_ADDR A:0x61b101f8
y.create.l HWIO_CAMSS_A_VFE_0_A_CAMIF_SUBSAMPLE_CFG_2_ADDR A:0x61b101fc
y.create.l HWIO_CAMSS_A_VFE_0_A_CAMIF_EPOCH_IRQ_ADDR A:0x61b10200
y.create.l HWIO_CAMSS_A_VFE_0_A_CAMIF_STATUS_ADDR A:0x61b10204
y.create.l HWIO_CAMSS_A_VFE_0_A_CAMIF_MISR_ADDR A:0x61b10208
y.create.l HWIO_CAMSS_A_VFE_0_A_VFE_SYNC_TIMER_CMD_ADDR A:0x61b1020c
y.create.l HWIO_CAMSS_A_VFE_0_A_VFE_SYNC_TIMER0_LINE_START_ADDR A:0x61b10210
y.create.l HWIO_CAMSS_A_VFE_0_A_VFE_SYNC_TIMER0_PIXEL_START_ADDR A:0x61b10214
y.create.l HWIO_CAMSS_A_VFE_0_A_VFE_SYNC_TIMER0_PIXEL_DURATION_ADDR A:0x61b10218
y.create.l HWIO_CAMSS_A_VFE_0_A_VFE_SYNC_TIMER1_LINE_START_ADDR A:0x61b1021c
y.create.l HWIO_CAMSS_A_VFE_0_A_VFE_SYNC_TIMER1_PIXEL_START_ADDR A:0x61b10220
y.create.l HWIO_CAMSS_A_VFE_0_A_VFE_SYNC_TIMER1_PIXEL_DURATION_ADDR A:0x61b10224
y.create.l HWIO_CAMSS_A_VFE_0_A_VFE_SYNC_TIMER2_LINE_START_ADDR A:0x61b10228
y.create.l HWIO_CAMSS_A_VFE_0_A_VFE_SYNC_TIMER2_PIXEL_START_ADDR A:0x61b1022c
y.create.l HWIO_CAMSS_A_VFE_0_A_VFE_SYNC_TIMER2_PIXEL_DURATION_ADDR A:0x61b10230
y.create.l HWIO_CAMSS_A_VFE_0_A_VFE_SYNC_TIMER_POLARITY_ADDR A:0x61b10234
y.create.l HWIO_CAMSS_A_VFE_0_A_VFE_ASYNC_TIMER_CMD_ADDR A:0x61b10238
y.create.l HWIO_CAMSS_A_VFE_0_A_VFE_ASYNC_TIMER0_CFG_0_ADDR A:0x61b1023c
y.create.l HWIO_CAMSS_A_VFE_0_A_VFE_ASYNC_TIMER0_CFG_1_ADDR A:0x61b10240
y.create.l HWIO_CAMSS_A_VFE_0_A_VFE_ASYNC_TIMER1_CFG_0_ADDR A:0x61b10244
y.create.l HWIO_CAMSS_A_VFE_0_A_VFE_ASYNC_TIMER1_CFG_1_ADDR A:0x61b10248
y.create.l HWIO_CAMSS_A_VFE_0_A_VFE_ASYNC_TIMER2_CFG_0_ADDR A:0x61b1024c
y.create.l HWIO_CAMSS_A_VFE_0_A_VFE_ASYNC_TIMER2_CFG_1_ADDR A:0x61b10250
y.create.l HWIO_CAMSS_A_VFE_0_A_VFE_ASYNC_TIMER3_CFG_0_ADDR A:0x61b10254
y.create.l HWIO_CAMSS_A_VFE_0_A_VFE_ASYNC_TIMER3_CFG_1_ADDR A:0x61b10258
y.create.l HWIO_CAMSS_A_VFE_0_A_VFE_TIMER_SEL_ADDR A:0x61b1025c
y.create.l HWIO_CAMSS_A_VFE_0_A_VFE_REG_UPDATE_CMD_ADDR A:0x61b10260
y.create.l HWIO_CAMSS_A_VFE_0_A_VFE_BLACK_CFG_ADDR A:0x61b10264
y.create.l HWIO_CAMSS_A_VFE_0_A_VFE_BLACK_INTERP_R_0_ADDR A:0x61b10268
y.create.l HWIO_CAMSS_A_VFE_0_A_VFE_BLACK_INTERP_R_1_ADDR A:0x61b1026c
y.create.l HWIO_CAMSS_A_VFE_0_A_VFE_BLACK_INTERP_R_2_ADDR A:0x61b10270
y.create.l HWIO_CAMSS_A_VFE_0_A_VFE_BLACK_INTERP_R_3_ADDR A:0x61b1067c
y.create.l HWIO_CAMSS_A_VFE_0_A_VFE_BLACK_INTERP_GB_0_ADDR A:0x61b10680
y.create.l HWIO_CAMSS_A_VFE_0_A_VFE_BLACK_INTERP_GB_1_ADDR A:0x61b10684
y.create.l HWIO_CAMSS_A_VFE_0_A_VFE_BLACK_INTERP_GB_2_ADDR A:0x61b10688
y.create.l HWIO_CAMSS_A_VFE_0_A_VFE_BLACK_INTERP_GB_3_ADDR A:0x61b1068c
y.create.l HWIO_CAMSS_A_VFE_0_A_VFE_BLACK_INTERP_B_0_ADDR A:0x61b10690
y.create.l HWIO_CAMSS_A_VFE_0_A_VFE_BLACK_INTERP_B_1_ADDR A:0x61b10694
y.create.l HWIO_CAMSS_A_VFE_0_A_VFE_BLACK_INTERP_B_2_ADDR A:0x61b10698
y.create.l HWIO_CAMSS_A_VFE_0_A_VFE_BLACK_INTERP_B_3_ADDR A:0x61b1069c
y.create.l HWIO_CAMSS_A_VFE_0_A_VFE_BLACK_INTERP_GR_0_ADDR A:0x61b106a0
y.create.l HWIO_CAMSS_A_VFE_0_A_VFE_BLACK_INTERP_GR_1_ADDR A:0x61b106a4
y.create.l HWIO_CAMSS_A_VFE_0_A_VFE_BLACK_INTERP_GR_2_ADDR A:0x61b106a8
y.create.l HWIO_CAMSS_A_VFE_0_A_VFE_BLACK_INTERP_GR_3_ADDR A:0x61b106ac
y.create.l HWIO_CAMSS_A_VFE_0_A_VFE_BLACK_RIGHT_INTERP_R_0_ADDR A:0x61b10740
y.create.l HWIO_CAMSS_A_VFE_0_A_VFE_BLACK_RIGHT_INTERP_R_1_ADDR A:0x61b10744
y.create.l HWIO_CAMSS_A_VFE_0_A_VFE_BLACK_RIGHT_INTERP_R_2_ADDR A:0x61b10748
y.create.l HWIO_CAMSS_A_VFE_0_A_VFE_BLACK_RIGHT_INTERP_R_3_ADDR A:0x61b1074c
y.create.l HWIO_CAMSS_A_VFE_0_A_VFE_BLACK_RIGHT_INTERP_GB_0_ADDR A:0x61b10750
y.create.l HWIO_CAMSS_A_VFE_0_A_VFE_BLACK_RIGHT_INTERP_GB_1_ADDR A:0x61b10754
y.create.l HWIO_CAMSS_A_VFE_0_A_VFE_BLACK_RIGHT_INTERP_GB_2_ADDR A:0x61b10758
y.create.l HWIO_CAMSS_A_VFE_0_A_VFE_BLACK_RIGHT_INTERP_GB_3_ADDR A:0x61b1075c
y.create.l HWIO_CAMSS_A_VFE_0_A_VFE_BLACK_RIGHT_INTERP_B_0_ADDR A:0x61b10760
y.create.l HWIO_CAMSS_A_VFE_0_A_VFE_BLACK_RIGHT_INTERP_B_1_ADDR A:0x61b10764
y.create.l HWIO_CAMSS_A_VFE_0_A_VFE_BLACK_RIGHT_INTERP_B_2_ADDR A:0x61b10768
y.create.l HWIO_CAMSS_A_VFE_0_A_VFE_BLACK_RIGHT_INTERP_B_3_ADDR A:0x61b1076c
y.create.l HWIO_CAMSS_A_VFE_0_A_VFE_BLACK_RIGHT_INTERP_GR_0_ADDR A:0x61b10770
y.create.l HWIO_CAMSS_A_VFE_0_A_VFE_BLACK_RIGHT_INTERP_GR_1_ADDR A:0x61b10774
y.create.l HWIO_CAMSS_A_VFE_0_A_VFE_BLACK_RIGHT_INTERP_GR_2_ADDR A:0x61b10780
y.create.l HWIO_CAMSS_A_VFE_0_A_VFE_BLACK_RIGHT_INTERP_GR_3_ADDR A:0x61b1078c
y.create.l HWIO_CAMSS_A_VFE_0_A_VFE_ROLLOFF_CFG_ADDR A:0x61b10274
y.create.l HWIO_CAMSS_A_VFE_0_A_VFE_ROLLOFF_GRID_CFG_0_ADDR A:0x61b10278
y.create.l HWIO_CAMSS_A_VFE_0_A_VFE_ROLLOFF_GRID_CFG_1_ADDR A:0x61b1027c
y.create.l HWIO_CAMSS_A_VFE_0_A_VFE_ROLLOFF_RIGHT_GRID_CFG_0_ADDR A:0x61b10280
y.create.l HWIO_CAMSS_A_VFE_0_A_VFE_ROLLOFF_RIGHT_GRID_CFG_1_ADDR A:0x61b107a8
y.create.l HWIO_CAMSS_A_VFE_0_A_VFE_ROLLOFF_STRIPE_CFG_0_ADDR A:0x61b107ac
y.create.l HWIO_CAMSS_A_VFE_0_A_VFE_ROLLOFF_STRIPE_CFG_1_ADDR A:0x61b107b0
y.create.l HWIO_CAMSS_A_VFE_0_A_VFE_DEMUX_CFG_ADDR A:0x61b10284
y.create.l HWIO_CAMSS_A_VFE_0_A_VFE_DEMUX_GAIN_0_ADDR A:0x61b10288
y.create.l HWIO_CAMSS_A_VFE_0_A_VFE_DEMUX_GAIN_1_ADDR A:0x61b1028c
y.create.l HWIO_CAMSS_A_VFE_0_A_VFE_DEMUX_RIGHT_GAIN_0_ADDR A:0x61b10790
y.create.l HWIO_CAMSS_A_VFE_0_A_VFE_DEMUX_RIGHT_GAIN_1_ADDR A:0x61b1079c
y.create.l HWIO_CAMSS_A_VFE_0_A_VFE_DEMUX_EVEN_CFG_ADDR A:0x61b10290
y.create.l HWIO_CAMSS_A_VFE_0_A_VFE_DEMUX_ODD_CFG_ADDR A:0x61b10294
y.create.l HWIO_CAMSS_A_VFE_0_A_VFE_DEMOSAIC_CFG_ADDR A:0x61b10298
y.create.l HWIO_CAMSS_A_VFE_0_A_VFE_DEMOSAIC_DBPC_CFG_ADDR A:0x61b1029c
y.create.l HWIO_CAMSS_A_VFE_0_A_VFE_DEMOSAIC_DBPC_OFFSET_CFG_0_ADDR A:0x61b102a0
y.create.l HWIO_CAMSS_A_VFE_0_A_VFE_DEMOSAIC_DBPC_OFFSET_CFG_1_ADDR A:0x61b10604
y.create.l HWIO_CAMSS_A_VFE_0_A_VFE_DEMOSAIC_DBPC_OFFSET_CFG_2_ADDR A:0x61b10608
y.create.l HWIO_CAMSS_A_VFE_0_A_VFE_DEMOSAIC_DBCC_CFG_ADDR A:0x61b1060c
y.create.l HWIO_CAMSS_A_VFE_0_A_VFE_DEMOSAIC_DBCC_OFFSET_CFG_0_ADDR A:0x61b10610
y.create.l HWIO_CAMSS_A_VFE_0_A_VFE_DEMOSAIC_DBCC_OFFSET_CFG_1_ADDR A:0x61b10614
y.create.l HWIO_CAMSS_A_VFE_0_A_VFE_DEMOSAIC_DBCC_OFFSET_CFG_2_ADDR A:0x61b10618
y.create.l HWIO_CAMSS_A_VFE_0_A_VFE_DEMOSAIC_ABF_GREEN_CFG_0_ADDR A:0x61b102a4
y.create.l HWIO_CAMSS_A_VFE_0_A_VFE_DEMOSAIC_ABF_GREEN_CFG_1_ADDR A:0x61b102a8
y.create.l HWIO_CAMSS_A_VFE_0_A_VFE_DEMOSAIC_ABF_GREEN_CFG_2_ADDR A:0x61b102ac
y.create.l HWIO_CAMSS_A_VFE_0_A_VFE_DEMOSAIC_ABF_GREEN_POS_LUT_0_ADDR A:0x61b102b0
y.create.l HWIO_CAMSS_A_VFE_0_A_VFE_DEMOSAIC_ABF_GREEN_POS_LUT_1_ADDR A:0x61b102b4
y.create.l HWIO_CAMSS_A_VFE_0_A_VFE_DEMOSAIC_ABF_GREEN_POS_LUT_2_ADDR A:0x61b102b8
y.create.l HWIO_CAMSS_A_VFE_0_A_VFE_DEMOSAIC_ABF_GREEN_POS_LUT_3_ADDR A:0x61b102bc
y.create.l HWIO_CAMSS_A_VFE_0_A_VFE_DEMOSAIC_ABF_GREEN_POS_LUT_4_ADDR A:0x61b102c0
y.create.l HWIO_CAMSS_A_VFE_0_A_VFE_DEMOSAIC_ABF_GREEN_POS_LUT_5_ADDR A:0x61b102c4
y.create.l HWIO_CAMSS_A_VFE_0_A_VFE_DEMOSAIC_ABF_GREEN_POS_LUT_6_ADDR A:0x61b102c8
y.create.l HWIO_CAMSS_A_VFE_0_A_VFE_DEMOSAIC_ABF_GREEN_POS_LUT_7_ADDR A:0x61b102cc
y.create.l HWIO_CAMSS_A_VFE_0_A_VFE_DEMOSAIC_ABF_GREEN_NEG_LUT_0_ADDR A:0x61b102d0
y.create.l HWIO_CAMSS_A_VFE_0_A_VFE_DEMOSAIC_ABF_GREEN_NEG_LUT_1_ADDR A:0x61b102d4
y.create.l HWIO_CAMSS_A_VFE_0_A_VFE_DEMOSAIC_ABF_GREEN_NEG_LUT_2_ADDR A:0x61b102d8
y.create.l HWIO_CAMSS_A_VFE_0_A_VFE_DEMOSAIC_ABF_GREEN_NEG_LUT_3_ADDR A:0x61b102dc
y.create.l HWIO_CAMSS_A_VFE_0_A_VFE_DEMOSAIC_ABF_BLUE_CFG_0_ADDR A:0x61b102e0
y.create.l HWIO_CAMSS_A_VFE_0_A_VFE_DEMOSAIC_ABF_BLUE_CFG_1_ADDR A:0x61b102e4
y.create.l HWIO_CAMSS_A_VFE_0_A_VFE_DEMOSAIC_ABF_BLUE_CFG_2_ADDR A:0x61b102e8
y.create.l HWIO_CAMSS_A_VFE_0_A_VFE_DEMOSAIC_ABF_BLUE_POS_LUT_0_ADDR A:0x61b102ec
y.create.l HWIO_CAMSS_A_VFE_0_A_VFE_DEMOSAIC_ABF_BLUE_POS_LUT_1_ADDR A:0x61b102f0
y.create.l HWIO_CAMSS_A_VFE_0_A_VFE_DEMOSAIC_ABF_BLUE_POS_LUT_2_ADDR A:0x61b102f4
y.create.l HWIO_CAMSS_A_VFE_0_A_VFE_DEMOSAIC_ABF_BLUE_POS_LUT_3_ADDR A:0x61b102f8
y.create.l HWIO_CAMSS_A_VFE_0_A_VFE_DEMOSAIC_ABF_BLUE_POS_LUT_4_ADDR A:0x61b102fc
y.create.l HWIO_CAMSS_A_VFE_0_A_VFE_DEMOSAIC_ABF_BLUE_POS_LUT_5_ADDR A:0x61b10300
y.create.l HWIO_CAMSS_A_VFE_0_A_VFE_DEMOSAIC_ABF_BLUE_POS_LUT_6_ADDR A:0x61b10304
y.create.l HWIO_CAMSS_A_VFE_0_A_VFE_DEMOSAIC_ABF_BLUE_POS_LUT_7_ADDR A:0x61b10308
y.create.l HWIO_CAMSS_A_VFE_0_A_VFE_DEMOSAIC_ABF_BLUE_NEG_LUT_0_ADDR A:0x61b1030c
y.create.l HWIO_CAMSS_A_VFE_0_A_VFE_DEMOSAIC_ABF_BLUE_NEG_LUT_1_ADDR A:0x61b10310
y.create.l HWIO_CAMSS_A_VFE_0_A_VFE_DEMOSAIC_ABF_BLUE_NEG_LUT_2_ADDR A:0x61b10314
y.create.l HWIO_CAMSS_A_VFE_0_A_VFE_DEMOSAIC_ABF_BLUE_NEG_LUT_3_ADDR A:0x61b10318
y.create.l HWIO_CAMSS_A_VFE_0_A_VFE_DEMOSAIC_ABF_RED_CFG_0_ADDR A:0x61b1031c
y.create.l HWIO_CAMSS_A_VFE_0_A_VFE_DEMOSAIC_ABF_RED_CFG_1_ADDR A:0x61b10320
y.create.l HWIO_CAMSS_A_VFE_0_A_VFE_DEMOSAIC_ABF_RED_CFG_2_ADDR A:0x61b10324
y.create.l HWIO_CAMSS_A_VFE_0_A_VFE_DEMOSAIC_ABF_RED_POS_LUT_0_ADDR A:0x61b10328
y.create.l HWIO_CAMSS_A_VFE_0_A_VFE_DEMOSAIC_ABF_RED_POS_LUT_1_ADDR A:0x61b1032c
y.create.l HWIO_CAMSS_A_VFE_0_A_VFE_DEMOSAIC_ABF_RED_POS_LUT_2_ADDR A:0x61b10330
y.create.l HWIO_CAMSS_A_VFE_0_A_VFE_DEMOSAIC_ABF_RED_POS_LUT_3_ADDR A:0x61b10334
y.create.l HWIO_CAMSS_A_VFE_0_A_VFE_DEMOSAIC_ABF_RED_POS_LUT_4_ADDR A:0x61b10338
y.create.l HWIO_CAMSS_A_VFE_0_A_VFE_DEMOSAIC_ABF_RED_POS_LUT_5_ADDR A:0x61b1033c
y.create.l HWIO_CAMSS_A_VFE_0_A_VFE_DEMOSAIC_ABF_RED_POS_LUT_6_ADDR A:0x61b10340
y.create.l HWIO_CAMSS_A_VFE_0_A_VFE_DEMOSAIC_ABF_RED_POS_LUT_7_ADDR A:0x61b10344
y.create.l HWIO_CAMSS_A_VFE_0_A_VFE_DEMOSAIC_ABF_RED_NEG_LUT_0_ADDR A:0x61b10348
y.create.l HWIO_CAMSS_A_VFE_0_A_VFE_DEMOSAIC_ABF_RED_NEG_LUT_1_ADDR A:0x61b1034c
y.create.l HWIO_CAMSS_A_VFE_0_A_VFE_DEMOSAIC_ABF_RED_NEG_LUT_2_ADDR A:0x61b10350
y.create.l HWIO_CAMSS_A_VFE_0_A_VFE_DEMOSAIC_ABF_RED_NEG_LUT_3_ADDR A:0x61b10354
y.create.l HWIO_CAMSS_A_VFE_0_A_VFE_DEMOSAIC_INTERP_WB_GAIN_0_ADDR A:0x61b1061c
y.create.l HWIO_CAMSS_A_VFE_0_A_VFE_DEMOSAIC_INTERP_WB_GAIN_1_ADDR A:0x61b10620
y.create.l HWIO_CAMSS_A_VFE_0_A_VFE_DEMOSAIC_INTERP_CLASSIFIER_0_ADDR A:0x61b10624
y.create.l HWIO_CAMSS_A_VFE_0_A_VFE_DEMOSAIC_INTERP_CLASSIFIER_1_ADDR A:0x61b10628
y.create.l HWIO_CAMSS_A_VFE_0_A_VFE_DEMOSAIC_INTERP_CLASSIFIER_2_ADDR A:0x61b1062c
y.create.l HWIO_CAMSS_A_VFE_0_A_VFE_DEMOSAIC_INTERP_CLASSIFIER_3_ADDR A:0x61b10630
y.create.l HWIO_CAMSS_A_VFE_0_A_VFE_DEMOSAIC_INTERP_CLASSIFIER_4_ADDR A:0x61b10634
y.create.l HWIO_CAMSS_A_VFE_0_A_VFE_DEMOSAIC_INTERP_CLASSIFIER_5_ADDR A:0x61b10638
y.create.l HWIO_CAMSS_A_VFE_0_A_VFE_DEMOSAIC_INTERP_CLASSIFIER_6_ADDR A:0x61b1063c
y.create.l HWIO_CAMSS_A_VFE_0_A_VFE_DEMOSAIC_INTERP_CLASSIFIER_7_ADDR A:0x61b10640
y.create.l HWIO_CAMSS_A_VFE_0_A_VFE_DEMOSAIC_INTERP_CLASSIFIER_8_ADDR A:0x61b10644
y.create.l HWIO_CAMSS_A_VFE_0_A_VFE_DEMOSAIC_INTERP_CLASSIFIER_9_ADDR A:0x61b10648
y.create.l HWIO_CAMSS_A_VFE_0_A_VFE_DEMOSAIC_INTERP_G_0_ADDR A:0x61b1066c
y.create.l HWIO_CAMSS_A_VFE_0_A_VFE_DEMOSAIC_INTERP_G_1_ADDR A:0x61b10670
y.create.l HWIO_CAMSS_A_VFE_0_A_VFE_DEMOSAIC_DBPC_STATS_ADDR A:0x61b10358
y.create.l HWIO_CAMSS_A_VFE_0_A_VFE_DEMOSAIC_DBCC_STATS_0_ADDR A:0x61b10674
y.create.l HWIO_CAMSS_A_VFE_0_A_VFE_DEMOSAIC_DBCC_STATS_1_ADDR A:0x61b10678
y.create.l HWIO_CAMSS_A_VFE_0_A_VFE_CHROMA_UPSAMPLE_CFG_ADDR A:0x61b1035c
y.create.l HWIO_CAMSS_A_VFE_0_A_VFE_CROP_WIDTH_CFG_ADDR A:0x61b10360
y.create.l HWIO_CAMSS_A_VFE_0_A_VFE_CROP_HEIGHT_CFG_ADDR A:0x61b10364
y.create.l HWIO_CAMSS_A_VFE_0_A_VFE_SCALE_CFG_ADDR A:0x61b10368
y.create.l HWIO_CAMSS_A_VFE_0_A_VFE_SCALE_H_IMAGE_SIZE_CFG_ADDR A:0x61b1036c
y.create.l HWIO_CAMSS_A_VFE_0_A_VFE_SCALE_H_PHASE_CFG_ADDR A:0x61b10370
y.create.l HWIO_CAMSS_A_VFE_0_A_VFE_SCALE_H_STRIPE_CFG_ADDR A:0x61b10374
y.create.l HWIO_CAMSS_A_VFE_0_A_VFE_SCALE_V_IMAGE_SIZE_CFG_ADDR A:0x61b10378
y.create.l HWIO_CAMSS_A_VFE_0_A_VFE_SCALE_V_PHASE_CFG_ADDR A:0x61b1037c
y.create.l HWIO_CAMSS_A_VFE_0_A_VFE_SCALE_V_STRIPE_CFG_ADDR A:0x61b10380
y.create.l HWIO_CAMSS_A_VFE_0_A_VFE_WB_CFG_ADDR A:0x61b10384
y.create.l HWIO_CAMSS_A_VFE_0_A_VFE_WB_RIGHT_CFG_ADDR A:0x61b107a0
y.create.l HWIO_CAMSS_A_VFE_0_A_VFE_CLF_CFG_ADDR A:0x61b106b0
y.create.l HWIO_CAMSS_A_VFE_0_A_VFE_CLF_LUMA_CFG_0_ADDR A:0x61b106b4
y.create.l HWIO_CAMSS_A_VFE_0_A_VFE_CLF_LUMA_CFG_1_ADDR A:0x61b106b8
y.create.l HWIO_CAMSS_A_VFE_0_A_VFE_CLF_LUMA_CFG_2_ADDR A:0x61b106bc
y.create.l HWIO_CAMSS_A_VFE_0_A_VFE_CLF_LUMA_POS_LUT_0_ADDR A:0x61b106c0
y.create.l HWIO_CAMSS_A_VFE_0_A_VFE_CLF_LUMA_POS_LUT_1_ADDR A:0x61b106c4
y.create.l HWIO_CAMSS_A_VFE_0_A_VFE_CLF_LUMA_POS_LUT_2_ADDR A:0x61b106c8
y.create.l HWIO_CAMSS_A_VFE_0_A_VFE_CLF_LUMA_POS_LUT_3_ADDR A:0x61b106cc
y.create.l HWIO_CAMSS_A_VFE_0_A_VFE_CLF_LUMA_POS_LUT_4_ADDR A:0x61b106d0
y.create.l HWIO_CAMSS_A_VFE_0_A_VFE_CLF_LUMA_POS_LUT_5_ADDR A:0x61b106d4
y.create.l HWIO_CAMSS_A_VFE_0_A_VFE_CLF_LUMA_POS_LUT_6_ADDR A:0x61b106d8
y.create.l HWIO_CAMSS_A_VFE_0_A_VFE_CLF_LUMA_POS_LUT_7_ADDR A:0x61b106dc
y.create.l HWIO_CAMSS_A_VFE_0_A_VFE_CLF_LUMA_NEG_LUT_0_ADDR A:0x61b106e0
y.create.l HWIO_CAMSS_A_VFE_0_A_VFE_CLF_LUMA_NEG_LUT_1_ADDR A:0x61b106e4
y.create.l HWIO_CAMSS_A_VFE_0_A_VFE_CLF_LUMA_NEG_LUT_2_ADDR A:0x61b106e8
y.create.l HWIO_CAMSS_A_VFE_0_A_VFE_CLF_LUMA_NEG_LUT_3_ADDR A:0x61b106ec
y.create.l HWIO_CAMSS_A_VFE_0_A_VFE_CLF_CHROMA_COEFF_0_ADDR A:0x61b106f0
y.create.l HWIO_CAMSS_A_VFE_0_A_VFE_CLF_CHROMA_COEFF_1_ADDR A:0x61b106f4
y.create.l HWIO_CAMSS_A_VFE_0_A_VFE_COLOR_CORRECT_COEFF_0_ADDR A:0x61b10388
y.create.l HWIO_CAMSS_A_VFE_0_A_VFE_COLOR_CORRECT_COEFF_1_ADDR A:0x61b1038c
y.create.l HWIO_CAMSS_A_VFE_0_A_VFE_COLOR_CORRECT_COEFF_2_ADDR A:0x61b10390
y.create.l HWIO_CAMSS_A_VFE_0_A_VFE_COLOR_CORRECT_COEFF_3_ADDR A:0x61b10394
y.create.l HWIO_CAMSS_A_VFE_0_A_VFE_COLOR_CORRECT_COEFF_4_ADDR A:0x61b10398
y.create.l HWIO_CAMSS_A_VFE_0_A_VFE_COLOR_CORRECT_COEFF_5_ADDR A:0x61b1039c
y.create.l HWIO_CAMSS_A_VFE_0_A_VFE_COLOR_CORRECT_COEFF_6_ADDR A:0x61b103a0
y.create.l HWIO_CAMSS_A_VFE_0_A_VFE_COLOR_CORRECT_COEFF_7_ADDR A:0x61b103a4
y.create.l HWIO_CAMSS_A_VFE_0_A_VFE_COLOR_CORRECT_COEFF_8_ADDR A:0x61b103a8
y.create.l HWIO_CAMSS_A_VFE_0_A_VFE_COLOR_CORRECT_OFFSET_0_ADDR A:0x61b103ac
y.create.l HWIO_CAMSS_A_VFE_0_A_VFE_COLOR_CORRECT_OFFSET_1_ADDR A:0x61b103b0
y.create.l HWIO_CAMSS_A_VFE_0_A_VFE_COLOR_CORRECT_OFFSET_2_ADDR A:0x61b103b4
y.create.l HWIO_CAMSS_A_VFE_0_A_VFE_COLOR_CORRECT_COEFF_Q_ADDR A:0x61b103b8
y.create.l HWIO_CAMSS_A_VFE_0_A_VFE_LUT_BANK_SEL_ADDR A:0x61b103bc
y.create.l HWIO_CAMSS_A_VFE_0_A_VFE_LA_CFG_ADDR A:0x61b103c0
y.create.l HWIO_CAMSS_A_VFE_0_A_VFE_COLOR_CONVERT_COEFF_0_ADDR A:0x61b103c4
y.create.l HWIO_CAMSS_A_VFE_0_A_VFE_COLOR_CONVERT_COEFF_1_ADDR A:0x61b103c8
y.create.l HWIO_CAMSS_A_VFE_0_A_VFE_COLOR_CONVERT_COEFF_2_ADDR A:0x61b103cc
y.create.l HWIO_CAMSS_A_VFE_0_A_VFE_COLOR_CONVERT_OFFSET_ADDR A:0x61b103d0
y.create.l HWIO_CAMSS_A_VFE_0_A_VFE_CHROMA_ENHAN_A_ADDR A:0x61b103d4
y.create.l HWIO_CAMSS_A_VFE_0_A_VFE_CHROMA_ENHAN_B_ADDR A:0x61b103d8
y.create.l HWIO_CAMSS_A_VFE_0_A_VFE_CHROMA_ENHAN_C_ADDR A:0x61b103dc
y.create.l HWIO_CAMSS_A_VFE_0_A_VFE_CHROMA_ENHAN_D_ADDR A:0x61b103e0
y.create.l HWIO_CAMSS_A_VFE_0_A_VFE_CHROMA_ENHAN_K_ADDR A:0x61b103e4
y.create.l HWIO_CAMSS_A_VFE_0_A_VFE_CHROMA_SUPPRESS_CFG_0_ADDR A:0x61b103e8
y.create.l HWIO_CAMSS_A_VFE_0_A_VFE_CHROMA_SUPPRESS_CFG_1_ADDR A:0x61b103ec
y.create.l HWIO_CAMSS_A_VFE_0_A_VFE_CHROMA_SUPPRESS_CFG_2_ADDR A:0x61b103f0
y.create.l HWIO_CAMSS_A_VFE_0_A_VFE_MCE_RED_CFG_0_ADDR A:0x61b103f4
y.create.l HWIO_CAMSS_A_VFE_0_A_VFE_MCE_RED_CFG_1_ADDR A:0x61b103f8
y.create.l HWIO_CAMSS_A_VFE_0_A_VFE_MCE_RED_CFG_2_ADDR A:0x61b103fc
y.create.l HWIO_CAMSS_A_VFE_0_A_VFE_MCE_GREEN_CFG_0_ADDR A:0x61b10400
y.create.l HWIO_CAMSS_A_VFE_0_A_VFE_MCE_GREEN_CFG_1_ADDR A:0x61b10404
y.create.l HWIO_CAMSS_A_VFE_0_A_VFE_MCE_GREEN_CFG_2_ADDR A:0x61b10408
y.create.l HWIO_CAMSS_A_VFE_0_A_VFE_MCE_BLUE_CFG_0_ADDR A:0x61b1040c
y.create.l HWIO_CAMSS_A_VFE_0_A_VFE_MCE_BLUE_CFG_1_ADDR A:0x61b10410
y.create.l HWIO_CAMSS_A_VFE_0_A_VFE_MCE_BLUE_CFG_2_ADDR A:0x61b10414
y.create.l HWIO_CAMSS_A_VFE_0_A_VFE_SKIN_ENHAN_CR_COORD_0_ADDR A:0x61b10418
y.create.l HWIO_CAMSS_A_VFE_0_A_VFE_SKIN_ENHAN_CR_COORD_1_ADDR A:0x61b1041c
y.create.l HWIO_CAMSS_A_VFE_0_A_VFE_SKIN_ENHAN_CR_COORD_2_ADDR A:0x61b10420
y.create.l HWIO_CAMSS_A_VFE_0_A_VFE_SKIN_ENHAN_CR_COORD_3_ADDR A:0x61b10424
y.create.l HWIO_CAMSS_A_VFE_0_A_VFE_SKIN_ENHAN_CR_COORD_4_ADDR A:0x61b10428
y.create.l HWIO_CAMSS_A_VFE_0_A_VFE_SKIN_ENHAN_CB_COORD_0_ADDR A:0x61b1042c
y.create.l HWIO_CAMSS_A_VFE_0_A_VFE_SKIN_ENHAN_CB_COORD_1_ADDR A:0x61b10430
y.create.l HWIO_CAMSS_A_VFE_0_A_VFE_SKIN_ENHAN_CB_COORD_2_ADDR A:0x61b10434
y.create.l HWIO_CAMSS_A_VFE_0_A_VFE_SKIN_ENHAN_CB_COORD_3_ADDR A:0x61b10438
y.create.l HWIO_CAMSS_A_VFE_0_A_VFE_SKIN_ENHAN_CB_COORD_4_ADDR A:0x61b1043c
y.create.l HWIO_CAMSS_A_VFE_0_A_VFE_SKIN_ENHAN_CR_COEFF_0_ADDR A:0x61b10440
y.create.l HWIO_CAMSS_A_VFE_0_A_VFE_SKIN_ENHAN_CR_COEFF_1_ADDR A:0x61b10444
y.create.l HWIO_CAMSS_A_VFE_0_A_VFE_SKIN_ENHAN_CR_COEFF_2_ADDR A:0x61b10448
y.create.l HWIO_CAMSS_A_VFE_0_A_VFE_SKIN_ENHAN_CR_COEFF_3_ADDR A:0x61b1044c
y.create.l HWIO_CAMSS_A_VFE_0_A_VFE_SKIN_ENHAN_CR_COEFF_4_ADDR A:0x61b10450
y.create.l HWIO_CAMSS_A_VFE_0_A_VFE_SKIN_ENHAN_CR_COEFF_5_ADDR A:0x61b10454
y.create.l HWIO_CAMSS_A_VFE_0_A_VFE_SKIN_ENHAN_CB_COEFF_0_ADDR A:0x61b10458
y.create.l HWIO_CAMSS_A_VFE_0_A_VFE_SKIN_ENHAN_CB_COEFF_1_ADDR A:0x61b1045c
y.create.l HWIO_CAMSS_A_VFE_0_A_VFE_SKIN_ENHAN_CB_COEFF_2_ADDR A:0x61b10460
y.create.l HWIO_CAMSS_A_VFE_0_A_VFE_SKIN_ENHAN_CB_COEFF_3_ADDR A:0x61b10464
y.create.l HWIO_CAMSS_A_VFE_0_A_VFE_SKIN_ENHAN_CB_COEFF_4_ADDR A:0x61b10468
y.create.l HWIO_CAMSS_A_VFE_0_A_VFE_SKIN_ENHAN_CB_COEFF_5_ADDR A:0x61b1046c
y.create.l HWIO_CAMSS_A_VFE_0_A_VFE_SKIN_ENHAN_CR_OFFSET_0_ADDR A:0x61b10470
y.create.l HWIO_CAMSS_A_VFE_0_A_VFE_SKIN_ENHAN_CR_OFFSET_1_ADDR A:0x61b10474
y.create.l HWIO_CAMSS_A_VFE_0_A_VFE_SKIN_ENHAN_CR_OFFSET_2_ADDR A:0x61b10478
y.create.l HWIO_CAMSS_A_VFE_0_A_VFE_SKIN_ENHAN_CR_OFFSET_3_ADDR A:0x61b1047c
y.create.l HWIO_CAMSS_A_VFE_0_A_VFE_SKIN_ENHAN_CR_OFFSET_4_ADDR A:0x61b10480
y.create.l HWIO_CAMSS_A_VFE_0_A_VFE_SKIN_ENHAN_CR_OFFSET_5_ADDR A:0x61b10484
y.create.l HWIO_CAMSS_A_VFE_0_A_VFE_SKIN_ENHAN_CB_OFFSET_0_ADDR A:0x61b10488
y.create.l HWIO_CAMSS_A_VFE_0_A_VFE_SKIN_ENHAN_CB_OFFSET_1_ADDR A:0x61b1048c
y.create.l HWIO_CAMSS_A_VFE_0_A_VFE_SKIN_ENHAN_CB_OFFSET_2_ADDR A:0x61b10490
y.create.l HWIO_CAMSS_A_VFE_0_A_VFE_SKIN_ENHAN_CB_OFFSET_3_ADDR A:0x61b10494
y.create.l HWIO_CAMSS_A_VFE_0_A_VFE_SKIN_ENHAN_CB_OFFSET_4_ADDR A:0x61b10498
y.create.l HWIO_CAMSS_A_VFE_0_A_VFE_SKIN_ENHAN_CB_OFFSET_5_ADDR A:0x61b1049c
y.create.l HWIO_CAMSS_A_VFE_0_A_VFE_ASF_CFG_ADDR A:0x61b104a0
y.create.l HWIO_CAMSS_A_VFE_0_A_VFE_ASF_SHARP_CFG_0_ADDR A:0x61b104a4
y.create.l HWIO_CAMSS_A_VFE_0_A_VFE_ASF_SHARP_CFG_1_ADDR A:0x61b104a8
y.create.l HWIO_CAMSS_A_VFE_0_A_VFE_ASF_SHARP_COEFF_0_ADDR A:0x61b104ac
y.create.l HWIO_CAMSS_A_VFE_0_A_VFE_ASF_SHARP_COEFF_1_ADDR A:0x61b104b0
y.create.l HWIO_CAMSS_A_VFE_0_A_VFE_ASF_SHARP_COEFF_2_ADDR A:0x61b104b4
y.create.l HWIO_CAMSS_A_VFE_0_A_VFE_ASF_SHARP_COEFF_3_ADDR A:0x61b104b8
y.create.l HWIO_CAMSS_A_VFE_0_A_VFE_ASF_SHARP_COEFF_4_ADDR A:0x61b104bc
y.create.l HWIO_CAMSS_A_VFE_0_A_VFE_ASF_SHARP_COEFF_5_ADDR A:0x61b104c0
y.create.l HWIO_CAMSS_A_VFE_0_A_VFE_ASF_MAX_EDGE_ADDR A:0x61b104c4
y.create.l HWIO_CAMSS_A_VFE_0_A_VFE_ASF_CROP_WIDTH_CFG_ADDR A:0x61b104c8
y.create.l HWIO_CAMSS_A_VFE_0_A_VFE_ASF_CROP_HEIGHT_CFG_ADDR A:0x61b104cc
y.create.l HWIO_CAMSS_A_VFE_0_A_VFE_ASF_SPECIAL_EFX_CFG_ADDR A:0x61b105fc
y.create.l HWIO_CAMSS_A_VFE_0_A_VFE_SCALE_Y_CFG_ADDR A:0x61b104d0
y.create.l HWIO_CAMSS_A_VFE_0_A_VFE_SCALE_Y_H_IMAGE_SIZE_CFG_ADDR A:0x61b104d4
y.create.l HWIO_CAMSS_A_VFE_0_A_VFE_SCALE_Y_H_PHASE_CFG_ADDR A:0x61b104d8
y.create.l HWIO_CAMSS_A_VFE_0_A_VFE_SCALE_Y_V_IMAGE_SIZE_CFG_ADDR A:0x61b104dc
y.create.l HWIO_CAMSS_A_VFE_0_A_VFE_SCALE_Y_V_PHASE_CFG_ADDR A:0x61b104e0
y.create.l HWIO_CAMSS_A_VFE_0_A_VFE_SCALE_CBCR_CFG_ADDR A:0x61b104e4
y.create.l HWIO_CAMSS_A_VFE_0_A_VFE_SCALE_CBCR_H_IMAGE_SIZE_CFG_ADDR A:0x61b104e8
y.create.l HWIO_CAMSS_A_VFE_0_A_VFE_SCALE_CBCR_H_PHASE_CFG_ADDR A:0x61b104ec
y.create.l HWIO_CAMSS_A_VFE_0_A_VFE_SCALE_CBCR_V_IMAGE_SIZE_CFG_ADDR A:0x61b104f0
y.create.l HWIO_CAMSS_A_VFE_0_A_VFE_SCALE_CBCR_V_PHASE_CFG_ADDR A:0x61b104f4
y.create.l HWIO_CAMSS_A_VFE_0_A_VFE_CHROMA_SUBSAMPLE_CFG_ADDR A:0x61b104f8
y.create.l HWIO_CAMSS_A_VFE_0_A_VFE_CHROMA_SUB_CROP_WIDTH_CFG_ADDR A:0x61b104fc
y.create.l HWIO_CAMSS_A_VFE_0_A_VFE_CHROMA_SUB_CROP_HEIGHT_CFG_ADDR A:0x61b10500
y.create.l HWIO_CAMSS_A_VFE_0_A_VFE_FRAMEDROP_ENC_Y_CFG_ADDR A:0x61b10504
y.create.l HWIO_CAMSS_A_VFE_0_A_VFE_FRAMEDROP_ENC_CBCR_CFG_ADDR A:0x61b10508
y.create.l HWIO_CAMSS_A_VFE_0_A_VFE_FRAMEDROP_ENC_Y_PATTERN_ADDR A:0x61b1050c
y.create.l HWIO_CAMSS_A_VFE_0_A_VFE_FRAMEDROP_ENC_CBCR_PATTERN_ADDR A:0x61b10510
y.create.l HWIO_CAMSS_A_VFE_0_A_VFE_FRAMEDROP_VIEW_Y_CFG_ADDR A:0x61b10514
y.create.l HWIO_CAMSS_A_VFE_0_A_VFE_FRAMEDROP_VIEW_CBCR_CFG_ADDR A:0x61b10518
y.create.l HWIO_CAMSS_A_VFE_0_A_VFE_FRAMEDROP_VIEW_Y_PATTERN_ADDR A:0x61b1051c
y.create.l HWIO_CAMSS_A_VFE_0_A_VFE_FRAMEDROP_VIEW_CBCR_PATTERN_ADDR A:0x61b10520
y.create.l HWIO_CAMSS_A_VFE_0_A_VFE_CLAMP_MAX_CFG_ADDR A:0x61b10524
y.create.l HWIO_CAMSS_A_VFE_0_A_VFE_CLAMP_MIN_CFG_ADDR A:0x61b10528
y.create.l HWIO_CAMSS_A_VFE_0_A_VFE_REALIGN_BUF_CFG_ADDR A:0x61b1052c
y.create.l HWIO_CAMSS_A_VFE_0_A_VFE_STATS_CFG_ADDR A:0x61b10530
y.create.l HWIO_CAMSS_A_VFE_0_A_VFE_STATS_BG_RGN_OFFSET_CFG_ADDR A:0x61b10700
y.create.l HWIO_CAMSS_A_VFE_0_A_VFE_STATS_BG_RGN_SIZE_CFG_ADDR A:0x61b10704
y.create.l HWIO_CAMSS_A_VFE_0_A_VFE_STATS_BG_THRESHOLD_CFG_ADDR A:0x61b10708
y.create.l HWIO_CAMSS_A_VFE_0_A_VFE_STATS_BF_RGN_OFFSET_CFG_ADDR A:0x61b1070c
y.create.l HWIO_CAMSS_A_VFE_0_A_VFE_STATS_BF_RGN_SIZE_CFG_ADDR A:0x61b10710
y.create.l HWIO_CAMSS_A_VFE_0_A_VFE_STATS_BF_FILTER_CFG_0_ADDR A:0x61b10714
y.create.l HWIO_CAMSS_A_VFE_0_A_VFE_STATS_BF_FILTER_CFG_1_ADDR A:0x61b10718
y.create.l HWIO_CAMSS_A_VFE_0_A_VFE_STATS_BF_FILTER_COEFF_0_ADDR A:0x61b1071c
y.create.l HWIO_CAMSS_A_VFE_0_A_VFE_STATS_BF_FILTER_COEFF_1_ADDR A:0x61b10820
y.create.l HWIO_CAMSS_A_VFE_0_A_VFE_STATS_BF_FILTER_COEFF_2_ADDR A:0x61b10828
y.create.l HWIO_CAMSS_A_VFE_0_A_VFE_STATS_BF_FILTER_COEFF_3_ADDR A:0x61b10720
y.create.l HWIO_CAMSS_A_VFE_0_A_VFE_STATS_BF_FILTER_COEFF_4_ADDR A:0x61b10824
y.create.l HWIO_CAMSS_A_VFE_0_A_VFE_STATS_BF_FILTER_COEFF_5_ADDR A:0x61b1082c
y.create.l HWIO_CAMSS_A_VFE_0_A_VFE_STATS_BHIST_RGN_OFFSET_CFG_ADDR A:0x61b10724
y.create.l HWIO_CAMSS_A_VFE_0_A_VFE_STATS_BHIST_RGN_SIZE_CFG_ADDR A:0x61b10728
y.create.l HWIO_CAMSS_A_VFE_0_A_VFE_STATS_AE_RGN_OFFSET_CFG_ADDR A:0x61b10534
y.create.l HWIO_CAMSS_A_VFE_0_A_VFE_STATS_AE_RGN_SIZE_CFG_ADDR A:0x61b10538
y.create.l HWIO_CAMSS_A_VFE_0_A_VFE_STATS_AF_RGN_OFFSET_CFG_ADDR A:0x61b1053c
y.create.l HWIO_CAMSS_A_VFE_0_A_VFE_STATS_AF_RGN_SIZE_CFG_ADDR A:0x61b10540
y.create.l HWIO_CAMSS_A_VFE_0_A_VFE_STATS_AF_HPF_COEFF_0_ADDR A:0x61b10544
y.create.l HWIO_CAMSS_A_VFE_0_A_VFE_STATS_AF_HPF_COEFF_1_ADDR A:0x61b10548
y.create.l HWIO_CAMSS_A_VFE_0_A_VFE_STATS_AWB_RGN_OFFSET_CFG_ADDR A:0x61b1054c
y.create.l HWIO_CAMSS_A_VFE_0_A_VFE_STATS_AWB_RGN_SIZE_CFG_ADDR A:0x61b10550
y.create.l HWIO_CAMSS_A_VFE_0_A_VFE_STATS_AWB_SGW_CFG_ADDR A:0x61b10554
y.create.l HWIO_CAMSS_A_VFE_0_A_VFE_STATS_AWB_AGW_CFG_0_ADDR A:0x61b10558
y.create.l HWIO_CAMSS_A_VFE_0_A_VFE_STATS_AWB_AGW_CFG_1_ADDR A:0x61b1055c
y.create.l HWIO_CAMSS_A_VFE_0_A_VFE_STATS_AWB_AGW_CFG_2_ADDR A:0x61b10560
y.create.l HWIO_CAMSS_A_VFE_0_A_VFE_STATS_AWB_GX_CFG_0_ADDR A:0x61b10564
y.create.l HWIO_CAMSS_A_VFE_0_A_VFE_STATS_AWB_GX_CFG_1_ADDR A:0x61b10568
y.create.l HWIO_CAMSS_A_VFE_0_A_VFE_STATS_RS_RGN_OFFSET_CFG_ADDR A:0x61b1056c
y.create.l HWIO_CAMSS_A_VFE_0_A_VFE_STATS_RS_RGN_SIZE_CFG_ADDR A:0x61b10570
y.create.l HWIO_CAMSS_A_VFE_0_A_VFE_STATS_CS_RGN_OFFSET_CFG_ADDR A:0x61b10574
y.create.l HWIO_CAMSS_A_VFE_0_A_VFE_STATS_CS_RGN_SIZE_CFG_ADDR A:0x61b10578
y.create.l HWIO_CAMSS_A_VFE_0_A_VFE_STATS_IHIST_RGN_OFFSET_CFG_ADDR A:0x61b1057c
y.create.l HWIO_CAMSS_A_VFE_0_A_VFE_STATS_IHIST_RGN_SIZE_CFG_ADDR A:0x61b10580
y.create.l HWIO_CAMSS_A_VFE_0_A_VFE_STATS_SKIN_RGN_OFFSET_CFG_ADDR A:0x61b10584
y.create.l HWIO_CAMSS_A_VFE_0_A_VFE_STATS_SKIN_RGN_SIZE_CFG_ADDR A:0x61b10588
y.create.l HWIO_CAMSS_A_VFE_0_A_VFE_STATS_SKIN_HUE_CFG_ADDR A:0x61b1058c
y.create.l HWIO_CAMSS_A_VFE_0_A_VFE_STATS_SKIN_Y_CFG_ADDR A:0x61b10590
y.create.l HWIO_CAMSS_A_VFE_0_A_VFE_STATS_SKIN_CBCR_CFG_ADDR A:0x61b10594
y.create.l HWIO_CAMSS_A_VFE_0_A_VFE_DMI_CFG_ADDR A:0x61b10598
y.create.l HWIO_CAMSS_A_VFE_0_A_VFE_DMI_ADDR_ADDR A:0x61b1059c
y.create.l HWIO_CAMSS_A_VFE_0_A_VFE_DMI_DATA_HI_ADDR A:0x61b105a0
y.create.l HWIO_CAMSS_A_VFE_0_A_VFE_DMI_DATA_LO_ADDR A:0x61b105a4
y.create.l HWIO_CAMSS_A_VFE_0_A_VFE_DMI_RAM_AUTO_LOAD_CMD_ADDR A:0x61b105a8
y.create.l HWIO_CAMSS_A_VFE_0_A_VFE_DMI_RAM_AUTO_LOAD_STATUS_ADDR A:0x61b105ac
y.create.l HWIO_CAMSS_A_VFE_0_A_VFE_DMI_RAM_AUTO_LOAD_CFG_ADDR A:0x61b105b0
y.create.l HWIO_CAMSS_A_VFE_0_A_VFE_DMI_RAM_AUTO_LOAD_SEED_ADDR A:0x61b105b4
y.create.l HWIO_CAMSS_A_VFE_0_A_VFE_TESTBUS_SEL_ADDR A:0x61b105b8
y.create.l HWIO_CAMSS_A_VFE_0_A_VFE_TESTGEN_CFG_ADDR A:0x61b105bc
y.create.l HWIO_CAMSS_A_VFE_0_A_VFE_SW_TESTGEN_CMD_ADDR A:0x61b105c0
y.create.l HWIO_CAMSS_A_VFE_0_A_VFE_HW_TESTGEN_CMD_ADDR A:0x61b105c4
y.create.l HWIO_CAMSS_A_VFE_0_A_VFE_HW_TESTGEN_CFG_ADDR A:0x61b105c8
y.create.l HWIO_CAMSS_A_VFE_0_A_VFE_HW_TESTGEN_IMAGE_CFG_ADDR A:0x61b105cc
y.create.l HWIO_CAMSS_A_VFE_0_A_VFE_HW_TESTGEN_SOF_OFFSET_CFG_ADDR A:0x61b105d0
y.create.l HWIO_CAMSS_A_VFE_0_A_VFE_HW_TESTGEN_EOF_NOFFSET_CFG_ADDR A:0x61b105d4
y.create.l HWIO_CAMSS_A_VFE_0_A_VFE_HW_TESTGEN_SOL_OFFSET_CFG_ADDR A:0x61b105d8
y.create.l HWIO_CAMSS_A_VFE_0_A_VFE_HW_TESTGEN_EOL_NOFFSET_CFG_ADDR A:0x61b105dc
y.create.l HWIO_CAMSS_A_VFE_0_A_VFE_HW_TESTGEN_HBI_CFG_ADDR A:0x61b105e0
y.create.l HWIO_CAMSS_A_VFE_0_A_VFE_HW_TESTGEN_VBL_CFG_ADDR A:0x61b105e4
y.create.l HWIO_CAMSS_A_VFE_0_A_VFE_HW_TESTGEN_COLOR_BARS_CFG_ADDR A:0x61b105f0
y.create.l HWIO_CAMSS_A_VFE_0_A_VFE_HW_TESTGEN_RANDOM_CFG_ADDR A:0x61b105f4
y.create.l HWIO_CAMSS_A_VFE_0_A_VFE_SPARE_ADDR A:0x61b105f8
y.create.l HWIO_CAMSS_A_VFE_0_A_VFE_CE_CLOCK_CONFIG_ADDR A:0x61b10f60
y.create.l HWIO_CAMSS_A_VFE_0_A_VFE_CE_SW_RESET_ADDR A:0x61b10f64
y.create.l HWIO_CAMSS_A_VFE_0_A_VFE_CE_ENABLE_ADDR A:0x61b10f68
y.create.l HWIO_CAMSS_A_VFE_0_A_VFE_CE_CMD_BUFFER_ENABLE_ADDR A:0x61b10f6c
y.create.l HWIO_CAMSS_A_VFE_0_A_VFE_CE_CMD_BUFFER_A_ADDR_ADDR A:0x61b10f70
y.create.l HWIO_CAMSS_A_VFE_0_A_VFE_CE_CMD_BUFFER_B_ADDR_ADDR A:0x61b10f74
y.create.l HWIO_CAMSS_A_VFE_0_A_VFE_CE_INTR_STATUS_ADDR A:0x61b10f78
y.create.l HWIO_CAMSS_A_VFE_0_A_VFE_CE_INTR_CLEAR_ADDR A:0x61b10f7c
y.create.l HWIO_CAMSS_A_VFE_0_A_VFE_CE_BUFFER_STATUS_ADDR A:0x61b10f80
y.create.l HWIO_CAMSS_A_VFE_0_A_VFE_CE_STATE_STATUS_ADDR A:0x61b10f84
y.create.l HWIO_CAMSS_A_VFE_0_A_VFE_CE_CURRENT_PTR_ADDR A:0x61b10f88
y.create.l HWIO_CAMSS_A_VFE_0_A_VFE_CE_PING_PONG_BUF_COUNT_ADDR A:0x61b10f8c
y.create.l HWIO_CAMSS_A_VFE_0_A_VFE_CE_CYCLE_COUNT_ADDR A:0x61b10f90
y.create.l HWIO_CAMSS_A_VFE_0_A_VFE_CE_MAX_PING_PONG_BUF_CYCLE_COUNT_ADDR A:0x61b10f94
y.create.l HWIO_CAMSS_A_VFE_0_A_VFE_CE_CMD_COUNT_ADDR A:0x61b10f98
y.create.l HWIO_CAMSS_A_VFE_0_A_VFE_CE_CMD_BUF_CYC_COUNT_ADDR A:0x61b10f9c
y.create.l HWIO_CAMSS_A_VFE_0_A_VFE_CE_PENDING_COMMAND_ADDR A:0x61b10fa0
y.create.l HWIO_CAMSS_A_VFE_0_A_VFE_CE_PENDING_CMD_DATA1_ADDR A:0x61b10fa4
y.create.l HWIO_CAMSS_A_VFE_0_A_VFE_CE_PENDING_CMD_DATA2_ADDR A:0x61b10fa8
y.create.l HWIO_CAMSS_A_VFE_0_A_VFE_CE_PENDING_CMD_DATA3_ADDR A:0x61b10fac
y.create.l HWIO_CAMSS_A_VFE_0_A_VFE_CE_EXE_COMMAND_ADDR A:0x61b10fb0
y.create.l HWIO_CAMSS_A_VFE_0_A_VFE_CE_EXE_CMD_DATA1_ADDR A:0x61b10fb4
y.create.l HWIO_CAMSS_A_VFE_0_A_VFE_CE_EXE_CMD_DATA2_ADDR A:0x61b10fb8
y.create.l HWIO_CAMSS_A_VFE_0_A_VFE_CE_EXE_CMD_DATA3_ADDR A:0x61b10fbc
y.create.l HWIO_CAMSS_A_VFE_0_A_VFE_CE_TESTBUS_OBSERVE_ADDR A:0x61b10fc0
y.create.l HWIO_CAMSS_A_VFE_0_A_VFE_CE_TEST_BUS_SEL_ADDR A:0x61b10fc4
y.create.l HWIO_CAMSS_A_VFE_0_A_VFE_CE_EXECUTE_NEXT_CMD_ADDR A:0x61b10fc8
y.create.l HWIO_CAMSS_A_VFE_0_A_VFE_CE_AXI_RD_THROTTLE_DIS_ADDR A:0x61b10fcc
y.create.l HWIO_CAMSS_A_VFE_0_A_VFE_CE_ARB_OVERRIDE_ADDR A:0x61b10fd0
y.create.l HWIO_CAMSS_A_VFE_0_A_VFE_CE_SPARE_ADDR A:0x61b10fd4
y.create.l HWIO_CAMSS_A_VFE_0_A_VFE_CE_PING_PONG_BUF_COUNT_STAT_ADDR A:0x61b10fe0
y.create.l HWIO_CAMSS_A_VFE_0_A_VFE_CE_CYCLE_COUNT_STAT_ADDR A:0x61b10fe4
y.create.l HWIO_CAMSS_A_VFE_0_A_VFE_CE_MAX_PING_PONG_BUF_CYCLE_COUNT_STAT_ADDR A:0x61b10fe8
y.create.l HWIO_CAMSS_A_VFE_0_A_VFE_CE_CMD_COUNT_STAT_ADDR A:0x61b10fec
y.create.l HWIO_CAMSS_A_VFE_0_A_VFE_CE_CMD_BUF_CYC_COUNT_STAT_ADDR A:0x61b10ff0
y.create.l HWIO_CAMSS_A_VBIF_VFE_VBIF_VERSION_ADDR A:0x61b40000
y.create.l HWIO_CAMSS_A_VBIF_VFE_VBIF_CLKON_ADDR A:0x61b40004
y.create.l HWIO_CAMSS_A_VBIF_VFE_VBIF_CLK_FORCE_CTRL0_ADDR A:0x61b40008
y.create.l HWIO_CAMSS_A_VBIF_VFE_VBIF_CLK_FORCE_CTRL1_ADDR A:0x61b4000c
y.create.l HWIO_CAMSS_A_VBIF_VFE_VBIF_QOS_OVERRIDE_EN_ADDR A:0x61b40010
y.create.l HWIO_CAMSS_A_VBIF_VFE_VBIF_PRILVL_ACT_PROP_EN_ADDR A:0x61b40014
y.create.l HWIO_CAMSS_A_VBIF_VFE_VBIF_QOS_OVERRIDE_REQPRI_ADDR A:0x61b40018
y.create.l HWIO_CAMSS_A_VBIF_VFE_VBIF_QOS_OVERRIDE_PRILVL_ADDR A:0x61b4001c
y.create.l HWIO_CAMSS_A_VBIF_VFE_VBIF_QOS_REMAP_00_ADDR A:0x61b40020
y.create.l HWIO_CAMSS_A_VBIF_VFE_VBIF_QOS_REMAP_01_ADDR A:0x61b40024
y.create.l HWIO_CAMSS_A_VBIF_VFE_VBIF_QOS_REMAP_10_ADDR A:0x61b40028
y.create.l HWIO_CAMSS_A_VBIF_VFE_VBIF_QOS_REMAP_11_ADDR A:0x61b4002c
y.create.l HWIO_CAMSS_A_VBIF_VFE_VBIF_IN_RD_LIM_CONF0_ADDR A:0x61b400b0
y.create.l HWIO_CAMSS_A_VBIF_VFE_VBIF_IN_WR_LIM_CONF0_ADDR A:0x61b400c0
y.create.l HWIO_CAMSS_A_VBIF_VFE_VBIF_OUT_RD_LIM_CONF0_ADDR A:0x61b400d0
y.create.l HWIO_CAMSS_A_VBIF_VFE_VBIF_OUT_WR_LIM_CONF0_ADDR A:0x61b400d4
y.create.l HWIO_CAMSS_A_VBIF_VFE_VBIF_DDR_OUT_MAX_BURST_ADDR A:0x61b400d8
y.create.l HWIO_CAMSS_A_VBIF_VFE_VBIF_ISO_SYNC_ADDR A:0x61b400e0
y.create.l HWIO_CAMSS_A_VBIF_VFE_VBIF_ARB_CTL_ADDR A:0x61b400f0
y.create.l HWIO_CAMSS_A_VBIF_VFE_VBIF_DDR_ARB_CONF0_ADDR A:0x61b400f4
y.create.l HWIO_CAMSS_A_VBIF_VFE_VBIF_FIXED_ARB_CONF0_ADDR A:0x61b40100
y.create.l HWIO_CAMSS_A_VBIF_VFE_VBIF_ROUND_ROBIN_QOS_ARB_ADDR A:0x61b40124
y.create.l HWIO_CAMSS_A_VBIF_VFE_VBIF_OUT_AXI_AMEMTYPE_CONF0_ADDR A:0x61b40160
y.create.l HWIO_CAMSS_A_VBIF_VFE_VBIF_OUT_AXI_AINST_OVERRIDE_EN_ADDR A:0x61b40168
y.create.l HWIO_CAMSS_A_VBIF_VFE_VBIF_OUT_AXI_AINST_ADDR A:0x61b4016c
y.create.l HWIO_CAMSS_A_VBIF_VFE_VBIF_OUT_AXI_ASHARED_ADDR A:0x61b40170
y.create.l HWIO_CAMSS_A_VBIF_VFE_VBIF_OUT_AXI_AINNERSHARED_ADDR A:0x61b40174
y.create.l HWIO_CAMSS_A_VBIF_VFE_VBIF_OUT_AXI_AOOO_EN_ADDR A:0x61b40178
y.create.l HWIO_CAMSS_A_VBIF_VFE_VBIF_OUT_AXI_AOOO_ADDR A:0x61b4017c
y.create.l HWIO_CAMSS_A_VBIF_VFE_VBIF_OUT_AXI_ANOALLOCATE_ADDR A:0x61b40180
y.create.l HWIO_CAMSS_A_VBIF_VFE_VBIF_WD_TIMEOUT_ADDR A:0x61b40184
y.create.l HWIO_CAMSS_A_VBIF_VFE_VBIF_PND_ERR_ADDR A:0x61b40190
y.create.l HWIO_CAMSS_A_VBIF_VFE_VBIF_SRC_ERR_ADDR A:0x61b40194
y.create.l HWIO_CAMSS_A_VBIF_VFE_VBIF_ERR_MASK_ADDR A:0x61b40198
y.create.l HWIO_CAMSS_A_VBIF_VFE_VBIF_ERR_CLR_ADDR A:0x61b4019c
y.create.l HWIO_CAMSS_A_VBIF_VFE_VBIF_ERR_INFO_ADDR A:0x61b401a0
y.create.l HWIO_CAMSS_A_VBIF_VFE_VBIF_AXI_TEST_CTL_ADDR A:0x61b401b0
y.create.l HWIO_CAMSS_A_VBIF_VFE_VBIF_AXI_TEST_OUT_ADDR A:0x61b401b4
y.create.l HWIO_CAMSS_A_VBIF_VFE_VBIF_XIN_HALT_CTRL0_ADDR A:0x61b40200
y.create.l HWIO_CAMSS_A_VBIF_VFE_VBIF_XIN_HALT_CTRL1_ADDR A:0x61b40204
y.create.l HWIO_CAMSS_A_VBIF_VFE_VBIF_AXI_HALT_CTRL0_ADDR A:0x61b40208
y.create.l HWIO_CAMSS_A_VBIF_VFE_VBIF_AXI_HALT_CTRL1_ADDR A:0x61b4020c
y.create.l HWIO_CAMSS_A_VBIF_VFE_VBIF_TEST_BUS_OUT_CTRL_ADDR A:0x61b40210
y.create.l HWIO_CAMSS_A_VBIF_VFE_VBIF_TEST_BUS1_CTRL0_ADDR A:0x61b40214
y.create.l HWIO_CAMSS_A_VBIF_VFE_VBIF_TEST_BUS1_CTRL1_ADDR A:0x61b40218
y.create.l HWIO_CAMSS_A_VBIF_VFE_VBIF_TEST_BUS2_CTRL0_ADDR A:0x61b4021c
y.create.l HWIO_CAMSS_A_VBIF_VFE_VBIF_TEST_BUS2_CTRL1_ADDR A:0x61b40220
y.create.l HWIO_CAMSS_A_VBIF_VFE_VBIF_TEST_BUS_AHB_CTRL_ADDR A:0x61b4022c
y.create.l HWIO_CAMSS_A_VBIF_VFE_VBIF_TEST_BUS_OUT_ADDR A:0x61b40230
y.create.l HWIO_CAMSS_A_VBIF_VFE_VBIF_ATB_CONF0_ADDR A:0x61b40240
y.create.l HWIO_CAMSS_A_VBIF_VFE_VBIF_ATB_CONF1_ADDR A:0x61b40244
y.create.l HWIO_CAMSS_A_VBIF_VFE_VBIF_ATB_CONF2_ADDR A:0x61b40248
y.create.l HWIO_CAMSS_A_VBIF_VFE_VBIF_ATB_CONF3_ADDR A:0x61b4024c
y.create.l HWIO_CAMSS_A_VBIF_VFE_VBIF_ATB_TEST_VALUE_ADDR A:0x61b40250
y.create.l HWIO_CAMSS_A_VBIF_VFE_VBIF_STM_CONF_ADDR A:0x61b40260
y.create.l HWIO_CAMSS_A_VBIF_VFE_VBIF_WR_BUF_FOR_AP_ADDR A:0x61b40270
y.create.l HWIO_CAMSS_A_VBIF_VFE_VBIF_PERF_CNT_EN0_ADDR A:0x61b40300
y.create.l HWIO_CAMSS_A_VBIF_VFE_VBIF_PERF_CNT_EN1_ADDR A:0x61b40304
y.create.l HWIO_CAMSS_A_VBIF_VFE_VBIF_PERF_CNT_EN2_ADDR A:0x61b40308
y.create.l HWIO_CAMSS_A_VBIF_VFE_VBIF_PERF_CNT_EN3_ADDR A:0x61b4030c
y.create.l HWIO_CAMSS_A_VBIF_VFE_VBIF_PERF_CNT_CLR0_ADDR A:0x61b40320
y.create.l HWIO_CAMSS_A_VBIF_VFE_VBIF_PERF_CNT_CLR1_ADDR A:0x61b40324
y.create.l HWIO_CAMSS_A_VBIF_VFE_VBIF_PERF_CNT_CLR2_ADDR A:0x61b40328
y.create.l HWIO_CAMSS_A_VBIF_VFE_VBIF_PERF_CNT_CLR3_ADDR A:0x61b4032c
y.create.l HWIO_CAMSS_A_VBIF_VFE_VBIF_PERF_CNT_SEL0_ADDR A:0x61b40340
y.create.l HWIO_CAMSS_A_VBIF_VFE_VBIF_PERF_CNT_SEL1_ADDR A:0x61b40344
y.create.l HWIO_CAMSS_A_VBIF_VFE_VBIF_PERF_CNT_SEL2_ADDR A:0x61b40348
y.create.l HWIO_CAMSS_A_VBIF_VFE_VBIF_PERF_CNT_SEL3_ADDR A:0x61b4034c
y.create.l HWIO_CAMSS_A_VBIF_VFE_VBIF_PERF_CNT_L0_ADDR A:0x61b40360
y.create.l HWIO_CAMSS_A_VBIF_VFE_VBIF_PERF_CNT_L1_ADDR A:0x61b40364
y.create.l HWIO_CAMSS_A_VBIF_VFE_VBIF_PERF_CNT_L2_ADDR A:0x61b40368
y.create.l HWIO_CAMSS_A_VBIF_VFE_VBIF_PERF_CNT_L3_ADDR A:0x61b4036c
y.create.l HWIO_CAMSS_A_VBIF_VFE_VBIF_PERF_CNT_H0_ADDR A:0x61b40380
y.create.l HWIO_CAMSS_A_VBIF_VFE_VBIF_PERF_CNT_H1_ADDR A:0x61b40384
y.create.l HWIO_CAMSS_A_VBIF_VFE_VBIF_PERF_CNT_H2_ADDR A:0x61b40388
y.create.l HWIO_CAMSS_A_VBIF_VFE_VBIF_PERF_CNT_H3_ADDR A:0x61b4038c
y.create.l HWIO_CAMSS_A_VBIF_VFE_VBIF_PERF_PWR_CNT_EN0_ADDR A:0x61b40400
y.create.l HWIO_CAMSS_A_VBIF_VFE_VBIF_PERF_PWR_CNT_EN1_ADDR A:0x61b40404
y.create.l HWIO_CAMSS_A_VBIF_VFE_VBIF_PERF_PWR_CNT_EN2_ADDR A:0x61b40408
y.create.l HWIO_CAMSS_A_VBIF_VFE_VBIF_PERF_PWR_CNT_CLR0_ADDR A:0x61b40420
y.create.l HWIO_CAMSS_A_VBIF_VFE_VBIF_PERF_PWR_CNT_CLR1_ADDR A:0x61b40424
y.create.l HWIO_CAMSS_A_VBIF_VFE_VBIF_PERF_PWR_CNT_CLR2_ADDR A:0x61b40428
y.create.l HWIO_CAMSS_A_VBIF_VFE_VBIF_PERF_PWR_CNT_L0_ADDR A:0x61b40440
y.create.l HWIO_CAMSS_A_VBIF_VFE_VBIF_PERF_PWR_CNT_L1_ADDR A:0x61b40444
y.create.l HWIO_CAMSS_A_VBIF_VFE_VBIF_PERF_PWR_CNT_L2_ADDR A:0x61b40448
y.create.l HWIO_CAMSS_A_VBIF_VFE_VBIF_PERF_PWR_CNT_H0_ADDR A:0x61b40460
y.create.l HWIO_CAMSS_A_VBIF_VFE_VBIF_PERF_PWR_CNT_H1_ADDR A:0x61b40464
y.create.l HWIO_CAMSS_A_VBIF_VFE_VBIF_PERF_PWR_CNT_H2_ADDR A:0x61b40468
y.create.l HWIO_CAMSS_A_VBIF_VFE_VBIF_MISR_CFG_A0_ADDR A:0x61b40480
y.create.l HWIO_CAMSS_A_VBIF_VFE_VBIF_MISR_COUNTER_ADDR A:0x61b40490
y.create.l HWIO_CAMSS_A_VBIF_VFE_VBIF_MISR_CLR_A0_ADDR A:0x61b40494
y.create.l HWIO_CAMSS_A_VBIF_VFE_VBIF_MISR_A0_SIG0_ADDR A:0x61b404a4
y.create.l HWIO_CAMSS_A_VBIF_VFE_VBIF_MISR_A0_SIG1_ADDR A:0x61b404a8
y.create.l HWIO_CAMSS_A_VBIF_VFE_VBIF_MISR_A0_SIG2_ADDR A:0x61b404ac
y.create.l HWIO_CAMSS_A_VBIF_VFE_VBIF_MISR_A0_SIG3_ADDR A:0x61b404b0
y.create.l HWIO_CAMSS_A_VBIF_VFE_VBIF_ATB_EN_ADDR A:0x61b41030
y.create.l HWIO_CAMSS_A_VBIF_VFE_VBIF_STM_EN_ADDR A:0x61b41040
y.create.l HWIO_CAMSS_A_VBIF_VFE_VBIF_DDR_OUTPUT_RECOVERABLE_HALT_CTRL0_ADDR A:0x61b42000
y.create.l HWIO_CAMSS_A_VBIF_VFE_VBIF_DDR_OUTPUT_RECOVERABLE_HALT_CTRL1_ADDR A:0x61b42004
y.create.l HWIO_GCC_GPLL0_MODE_ADDR A:0x61821000
y.create.l HWIO_GCC_GPLL0_L_VAL_ADDR A:0x61821004
y.create.l HWIO_GCC_GPLL0_ALPHA_VAL_ADDR A:0x61821008
y.create.l HWIO_GCC_GPLL0_ALPHA_VAL_U_ADDR A:0x6182100c
y.create.l HWIO_GCC_GPLL0_USER_CTL_ADDR A:0x61821010
y.create.l HWIO_GCC_GPLL0_USER_CTL_U_ADDR A:0x61821014
y.create.l HWIO_GCC_GPLL0_CONFIG_CTL_ADDR A:0x61821018
y.create.l HWIO_GCC_GPLL0_TEST_CTL_ADDR A:0x6182101c
y.create.l HWIO_GCC_GPLL0_TEST_CTL_U_ADDR A:0x61821020
y.create.l HWIO_GCC_GPLL0_STATUS_ADDR A:0x61821024
y.create.l HWIO_GCC_GPLL0_FREQ_CTL_ADDR A:0x61821028
y.create.l HWIO_GCC_GPLL1_MODE_ADDR A:0x61820000
y.create.l HWIO_GCC_GPLL1_L_VAL_ADDR A:0x61820004
y.create.l HWIO_GCC_GPLL1_M_VAL_ADDR A:0x61820008
y.create.l HWIO_GCC_GPLL1_N_VAL_ADDR A:0x6182000c
y.create.l HWIO_GCC_GPLL1_USER_CTL_ADDR A:0x61820010
y.create.l HWIO_GCC_GPLL1_CONFIG_CTL_ADDR A:0x61820014
y.create.l HWIO_GCC_GPLL1_TEST_CTL_ADDR A:0x61820018
y.create.l HWIO_GCC_GPLL1_STATUS_ADDR A:0x6182001c
y.create.l HWIO_GCC_GPLL2_MODE_ADDR A:0x61825000
y.create.l HWIO_GCC_GPLL2_L_VAL_ADDR A:0x61825004
y.create.l HWIO_GCC_GPLL2_ALPHA_VAL_ADDR A:0x61825008
y.create.l HWIO_GCC_GPLL2_ALPHA_VAL_U_ADDR A:0x6182500c
y.create.l HWIO_GCC_GPLL2_USER_CTL_ADDR A:0x61825010
y.create.l HWIO_GCC_GPLL2_USER_CTL_U_ADDR A:0x61825014
y.create.l HWIO_GCC_GPLL2_CONFIG_CTL_ADDR A:0x61825018
y.create.l HWIO_GCC_GPLL2_TEST_CTL_ADDR A:0x6182501c
y.create.l HWIO_GCC_GPLL2_TEST_CTL_U_ADDR A:0x61825020
y.create.l HWIO_GCC_GPLL2_STATUS_ADDR A:0x61825024
y.create.l HWIO_GCC_GPLL2_FREQ_CTL_ADDR A:0x61825028
y.create.l HWIO_GCC_BIMC_PLL_MODE_ADDR A:0x61823000
y.create.l HWIO_GCC_BIMC_PLL_L_VAL_ADDR A:0x61823004
y.create.l HWIO_GCC_BIMC_PLL_ALPHA_VAL_ADDR A:0x61823008
y.create.l HWIO_GCC_BIMC_PLL_ALPHA_VAL_U_ADDR A:0x6182300c
y.create.l HWIO_GCC_BIMC_PLL_USER_CTL_ADDR A:0x61823010
y.create.l HWIO_GCC_BIMC_PLL_USER_CTL_U_ADDR A:0x61823014
y.create.l HWIO_GCC_BIMC_PLL_CONFIG_CTL_ADDR A:0x61823018
y.create.l HWIO_GCC_BIMC_PLL_TEST_CTL_ADDR A:0x6182301c
y.create.l HWIO_GCC_BIMC_PLL_TEST_CTL_U_ADDR A:0x61823020
y.create.l HWIO_GCC_BIMC_PLL_STATUS_ADDR A:0x61823024
y.create.l HWIO_GCC_BIMC_PLL_FREQ_CTL_ADDR A:0x61823028
y.create.l HWIO_GCC_SYSTEM_NOC_BCR_ADDR A:0x61826000
y.create.l HWIO_GCC_SYSTEM_NOC_BFDCD_CMD_RCGR_ADDR A:0x61826004
y.create.l HWIO_GCC_SYSTEM_NOC_BFDCD_CFG_RCGR_ADDR A:0x61826008
y.create.l HWIO_GCC_SNOC_QOSGEN_EXTREF_CTL_ADDR A:0x6182601c
y.create.l HWIO_GCC_PCNOC_BFDCD_CMD_RCGR_ADDR A:0x61827000
y.create.l HWIO_GCC_PCNOC_BFDCD_CFG_RCGR_ADDR A:0x61827004
y.create.l HWIO_GCC_SYS_NOC_AXI_CBCR_ADDR A:0x61826020
y.create.l HWIO_GCC_SYS_NOC_QDSS_STM_AXI_CBCR_ADDR A:0x61826024
y.create.l HWIO_GCC_SYS_NOC_APSS_AHB_CBCR_ADDR A:0x61826028
y.create.l HWIO_GCC_SNOC_PCNOC_AHB_CBCR_ADDR A:0x6182602c
y.create.l HWIO_GCC_SYS_NOC_AT_CBCR_ADDR A:0x61826030
y.create.l HWIO_GCC_PCNOC_BCR_ADDR A:0x61827018
y.create.l HWIO_GCC_PCNOC_AHB_CBCR_ADDR A:0x6182701c
y.create.l HWIO_GCC_PCNOC_DDR_CFG_CBCR_ADDR A:0x61832024
y.create.l HWIO_GCC_PCNOC_RPM_AHB_CBCR_ADDR A:0x61827024
y.create.l HWIO_GCC_PCNOC_AT_CBCR_ADDR A:0x61827028
y.create.l HWIO_GCC_NOC_CONF_XPU_AHB_CBCR_ADDR A:0x61817000
y.create.l HWIO_GCC_IMEM_BCR_ADDR A:0x6180e000
y.create.l HWIO_GCC_IMEM_AXI_CBCR_ADDR A:0x6180e004
y.create.l HWIO_GCC_IMEM_CFG_AHB_CBCR_ADDR A:0x6180e008
y.create.l HWIO_GCC_MMSS_BCR_ADDR A:0x6184b000
y.create.l HWIO_GCC_BIMC_GFX_CBCR_ADDR A:0x61831024
y.create.l HWIO_GCC_MSS_CFG_AHB_CBCR_ADDR A:0x61849000
y.create.l HWIO_GCC_MSS_Q6_BIMC_AXI_CBCR_ADDR A:0x61849004
y.create.l HWIO_GCC_RPM_CFG_XPU_CBCR_ADDR A:0x61817004
y.create.l HWIO_GCC_QDSS_BCR_ADDR A:0x61829000
y.create.l HWIO_GCC_QDSS_DAP_AHB_CBCR_ADDR A:0x61829004
y.create.l HWIO_GCC_QDSS_CFG_AHB_CBCR_ADDR A:0x61829008
y.create.l HWIO_GCC_QDSS_AT_CMD_RCGR_ADDR A:0x6182900c
y.create.l HWIO_GCC_QDSS_AT_CFG_RCGR_ADDR A:0x61829010
y.create.l HWIO_GCC_QDSS_AT_CBCR_ADDR A:0x61829024
y.create.l HWIO_GCC_QDSS_ETR_USB_CBCR_ADDR A:0x61829028
y.create.l HWIO_GCC_QDSS_STM_CMD_RCGR_ADDR A:0x6182902c
y.create.l HWIO_GCC_QDSS_STM_CFG_RCGR_ADDR A:0x61829030
y.create.l HWIO_GCC_QDSS_STM_CBCR_ADDR A:0x61829044
y.create.l HWIO_GCC_QDSS_TRACECLKIN_CMD_RCGR_ADDR A:0x61829048
y.create.l HWIO_GCC_QDSS_TRACECLKIN_CFG_RCGR_ADDR A:0x6182904c
y.create.l HWIO_GCC_QDSS_TRACECLKIN_CBCR_ADDR A:0x61829060
y.create.l HWIO_GCC_QDSS_TSCTR_CMD_RCGR_ADDR A:0x61829064
y.create.l HWIO_GCC_QDSS_TSCTR_CFG_RCGR_ADDR A:0x61829068
y.create.l HWIO_GCC_QDSS_TSCTR_DIV2_CBCR_ADDR A:0x6182907c
y.create.l HWIO_GCC_QDSS_TSCTR_DIV3_CBCR_ADDR A:0x61829080
y.create.l HWIO_GCC_QDSS_DAP_CBCR_ADDR A:0x61829084
y.create.l HWIO_GCC_QDSS_TSCTR_DIV4_CBCR_ADDR A:0x61829088
y.create.l HWIO_GCC_QDSS_TSCTR_DIV8_CBCR_ADDR A:0x6182908c
y.create.l HWIO_GCC_QDSS_TSCTR_DIV16_CBCR_ADDR A:0x61829090
y.create.l HWIO_GCC_QPIC_BCR_ADDR A:0x6183f000
y.create.l HWIO_GCC_QPIC_CMD_RCGR_ADDR A:0x6183f004
y.create.l HWIO_GCC_QPIC_CFG_RCGR_ADDR A:0x6183f008
y.create.l HWIO_GCC_QPIC_M_ADDR A:0x6183f00c
y.create.l HWIO_GCC_QPIC_N_ADDR A:0x6183f010
y.create.l HWIO_GCC_QPIC_D_ADDR A:0x6183f014
y.create.l HWIO_GCC_QPIC_CBCR_ADDR A:0x6183f018
y.create.l HWIO_GCC_QPIC_AHB_CBCR_ADDR A:0x6183f01c
y.create.l HWIO_GCC_QPIC_SYSTEM_CBCR_ADDR A:0x6183f020
y.create.l HWIO_GCC_GCC_SLEEP_CMD_RCGR_ADDR A:0x61830000
y.create.l HWIO_GCC_USB_HS_BCR_ADDR A:0x61841000
y.create.l HWIO_GCC_USB_HS_SYSTEM_CBCR_ADDR A:0x61841004
y.create.l HWIO_GCC_USB_HS_AHB_CBCR_ADDR A:0x61841008
y.create.l HWIO_GCC_USB_HS_PHY_CFG_AHB_CBCR_ADDR A:0x61841030
y.create.l HWIO_GCC_USB_HS_INACTIVITY_TIMERS_CBCR_ADDR A:0x6184100c
y.create.l HWIO_GCC_USB_HS_SYSTEM_CMD_RCGR_ADDR A:0x61841010
y.create.l HWIO_GCC_USB_HS_SYSTEM_CFG_RCGR_ADDR A:0x61841014
y.create.l HWIO_GCC_USB2A_PHY_BCR_ADDR A:0x61841028
y.create.l HWIO_GCC_USB2_HS_PHY_ONLY_BCR_ADDR A:0x61841034
y.create.l HWIO_GCC_USB_HS_PHY_CFG_AHB_BCR_ADDR A:0x61841038
y.create.l HWIO_GCC_QUSB2_PHY_BCR_ADDR A:0x6184103c
y.create.l HWIO_GCC_USB2A_PHY_SLEEP_CBCR_ADDR A:0x6184102c
y.create.l HWIO_GCC_SDCC1_BCR_ADDR A:0x61842000
y.create.l HWIO_GCC_SDCC1_APPS_CMD_RCGR_ADDR A:0x61842004
y.create.l HWIO_GCC_SDCC1_APPS_CFG_RCGR_ADDR A:0x61842008
y.create.l HWIO_GCC_SDCC1_APPS_M_ADDR A:0x6184200c
y.create.l HWIO_GCC_SDCC1_APPS_N_ADDR A:0x61842010
y.create.l HWIO_GCC_SDCC1_APPS_D_ADDR A:0x61842014
y.create.l HWIO_GCC_SDCC1_APPS_CBCR_ADDR A:0x61842018
y.create.l HWIO_GCC_SDCC1_AHB_CBCR_ADDR A:0x6184201c
y.create.l HWIO_GCC_SDCC1_MISC_ADDR A:0x61842020
y.create.l HWIO_GCC_SDCC2_BCR_ADDR A:0x61843000
y.create.l HWIO_GCC_SDCC2_APPS_CMD_RCGR_ADDR A:0x61843004
y.create.l HWIO_GCC_SDCC2_APPS_CFG_RCGR_ADDR A:0x61843008
y.create.l HWIO_GCC_SDCC2_APPS_M_ADDR A:0x6184300c
y.create.l HWIO_GCC_SDCC2_APPS_N_ADDR A:0x61843010
y.create.l HWIO_GCC_SDCC2_APPS_D_ADDR A:0x61843014
y.create.l HWIO_GCC_SDCC2_APPS_CBCR_ADDR A:0x61843018
y.create.l HWIO_GCC_SDCC2_AHB_CBCR_ADDR A:0x6184301c
y.create.l HWIO_GCC_BLSP1_BCR_ADDR A:0x61801000
y.create.l HWIO_GCC_BLSP1_SLEEP_CBCR_ADDR A:0x61801004
y.create.l HWIO_GCC_BLSP1_AHB_CBCR_ADDR A:0x61801008
y.create.l HWIO_GCC_BLSP1_QUP1_BCR_ADDR A:0x61802000
y.create.l HWIO_GCC_BLSP1_QUP1_SPI_APPS_CBCR_ADDR A:0x61802004
y.create.l HWIO_GCC_BLSP1_QUP1_I2C_APPS_CBCR_ADDR A:0x61802008
y.create.l HWIO_GCC_BLSP1_QUP1_I2C_APPS_CMD_RCGR_ADDR A:0x6180200c
y.create.l HWIO_GCC_BLSP1_QUP1_I2C_APPS_CFG_RCGR_ADDR A:0x61802010
y.create.l HWIO_GCC_BLSP1_QUP2_I2C_APPS_CMD_RCGR_ADDR A:0x61803000
y.create.l HWIO_GCC_BLSP1_QUP2_I2C_APPS_CFG_RCGR_ADDR A:0x61803004
y.create.l HWIO_GCC_BLSP1_QUP3_I2C_APPS_CMD_RCGR_ADDR A:0x61804000
y.create.l HWIO_GCC_BLSP1_QUP3_I2C_APPS_CFG_RCGR_ADDR A:0x61804004
y.create.l HWIO_GCC_BLSP1_QUP4_I2C_APPS_CMD_RCGR_ADDR A:0x61805000
y.create.l HWIO_GCC_BLSP1_QUP4_I2C_APPS_CFG_RCGR_ADDR A:0x61805004
y.create.l HWIO_GCC_BLSP1_QUP5_I2C_APPS_CMD_RCGR_ADDR A:0x61806000
y.create.l HWIO_GCC_BLSP1_QUP5_I2C_APPS_CFG_RCGR_ADDR A:0x61806004
y.create.l HWIO_GCC_BLSP1_QUP6_I2C_APPS_CMD_RCGR_ADDR A:0x61807000
y.create.l HWIO_GCC_BLSP1_QUP6_I2C_APPS_CFG_RCGR_ADDR A:0x61807004
y.create.l HWIO_GCC_BLSP1_QUP1_SPI_APPS_CMD_RCGR_ADDR A:0x61802024
y.create.l HWIO_GCC_BLSP1_QUP1_SPI_APPS_CFG_RCGR_ADDR A:0x61802028
y.create.l HWIO_GCC_BLSP1_QUP1_SPI_APPS_M_ADDR A:0x6180202c
y.create.l HWIO_GCC_BLSP1_QUP1_SPI_APPS_N_ADDR A:0x61802030
y.create.l HWIO_GCC_BLSP1_QUP1_SPI_APPS_D_ADDR A:0x61802034
y.create.l HWIO_GCC_BLSP1_UART1_BCR_ADDR A:0x61802038
y.create.l HWIO_GCC_BLSP1_UART1_APPS_CBCR_ADDR A:0x6180203c
y.create.l HWIO_GCC_BLSP1_UART1_SIM_CBCR_ADDR A:0x61802040
y.create.l HWIO_GCC_BLSP1_UART1_APPS_CMD_RCGR_ADDR A:0x61802044
y.create.l HWIO_GCC_BLSP1_UART1_APPS_CFG_RCGR_ADDR A:0x61802048
y.create.l HWIO_GCC_BLSP1_UART1_APPS_M_ADDR A:0x6180204c
y.create.l HWIO_GCC_BLSP1_UART1_APPS_N_ADDR A:0x61802050
y.create.l HWIO_GCC_BLSP1_UART1_APPS_D_ADDR A:0x61802054
y.create.l HWIO_GCC_BLSP1_QUP2_BCR_ADDR A:0x61803008
y.create.l HWIO_GCC_BLSP1_QUP2_SPI_APPS_CBCR_ADDR A:0x6180300c
y.create.l HWIO_GCC_BLSP1_QUP2_I2C_APPS_CBCR_ADDR A:0x61803010
y.create.l HWIO_GCC_BLSP1_QUP2_SPI_APPS_CMD_RCGR_ADDR A:0x61803014
y.create.l HWIO_GCC_BLSP1_QUP2_SPI_APPS_CFG_RCGR_ADDR A:0x61803018
y.create.l HWIO_GCC_BLSP1_QUP2_SPI_APPS_M_ADDR A:0x6180301c
y.create.l HWIO_GCC_BLSP1_QUP2_SPI_APPS_N_ADDR A:0x61803020
y.create.l HWIO_GCC_BLSP1_QUP2_SPI_APPS_D_ADDR A:0x61803024
y.create.l HWIO_GCC_BLSP1_UART2_BCR_ADDR A:0x61803028
y.create.l HWIO_GCC_BLSP1_UART2_APPS_CBCR_ADDR A:0x6180302c
y.create.l HWIO_GCC_BLSP1_UART2_SIM_CBCR_ADDR A:0x61803030
y.create.l HWIO_GCC_BLSP1_UART2_APPS_CMD_RCGR_ADDR A:0x61803034
y.create.l HWIO_GCC_BLSP1_UART2_APPS_CFG_RCGR_ADDR A:0x61803038
y.create.l HWIO_GCC_BLSP1_UART2_APPS_M_ADDR A:0x6180303c
y.create.l HWIO_GCC_BLSP1_UART2_APPS_N_ADDR A:0x61803040
y.create.l HWIO_GCC_BLSP1_UART2_APPS_D_ADDR A:0x61803044
y.create.l HWIO_GCC_BLSP1_QUP3_BCR_ADDR A:0x61804018
y.create.l HWIO_GCC_BLSP1_QUP3_SPI_APPS_CBCR_ADDR A:0x6180401c
y.create.l HWIO_GCC_BLSP1_QUP3_I2C_APPS_CBCR_ADDR A:0x61804020
y.create.l HWIO_GCC_BLSP1_QUP3_SPI_APPS_CMD_RCGR_ADDR A:0x61804024
y.create.l HWIO_GCC_BLSP1_QUP3_SPI_APPS_CFG_RCGR_ADDR A:0x61804028
y.create.l HWIO_GCC_BLSP1_QUP3_SPI_APPS_M_ADDR A:0x6180402c
y.create.l HWIO_GCC_BLSP1_QUP3_SPI_APPS_N_ADDR A:0x61804030
y.create.l HWIO_GCC_BLSP1_QUP3_SPI_APPS_D_ADDR A:0x61804034
y.create.l HWIO_GCC_BLSP1_QUP4_BCR_ADDR A:0x61805018
y.create.l HWIO_GCC_BLSP1_QUP4_SPI_APPS_CBCR_ADDR A:0x6180501c
y.create.l HWIO_GCC_BLSP1_QUP4_I2C_APPS_CBCR_ADDR A:0x61805020
y.create.l HWIO_GCC_BLSP1_QUP4_SPI_APPS_CMD_RCGR_ADDR A:0x61805024
y.create.l HWIO_GCC_BLSP1_QUP4_SPI_APPS_CFG_RCGR_ADDR A:0x61805028
y.create.l HWIO_GCC_BLSP1_QUP4_SPI_APPS_M_ADDR A:0x6180502c
y.create.l HWIO_GCC_BLSP1_QUP4_SPI_APPS_N_ADDR A:0x61805030
y.create.l HWIO_GCC_BLSP1_QUP4_SPI_APPS_D_ADDR A:0x61805034
y.create.l HWIO_GCC_BLSP1_QUP5_BCR_ADDR A:0x61806018
y.create.l HWIO_GCC_BLSP1_QUP5_SPI_APPS_CBCR_ADDR A:0x6180601c
y.create.l HWIO_GCC_BLSP1_QUP5_I2C_APPS_CBCR_ADDR A:0x61806020
y.create.l HWIO_GCC_BLSP1_QUP5_SPI_APPS_CMD_RCGR_ADDR A:0x61806024
y.create.l HWIO_GCC_BLSP1_QUP5_SPI_APPS_CFG_RCGR_ADDR A:0x61806028
y.create.l HWIO_GCC_BLSP1_QUP5_SPI_APPS_M_ADDR A:0x6180602c
y.create.l HWIO_GCC_BLSP1_QUP5_SPI_APPS_N_ADDR A:0x61806030
y.create.l HWIO_GCC_BLSP1_QUP5_SPI_APPS_D_ADDR A:0x61806034
y.create.l HWIO_GCC_BLSP1_QUP6_BCR_ADDR A:0x61807018
y.create.l HWIO_GCC_BLSP1_QUP6_SPI_APPS_CBCR_ADDR A:0x6180701c
y.create.l HWIO_GCC_BLSP1_QUP6_I2C_APPS_CBCR_ADDR A:0x61807020
y.create.l HWIO_GCC_BLSP1_QUP6_SPI_APPS_CMD_RCGR_ADDR A:0x61807024
y.create.l HWIO_GCC_BLSP1_QUP6_SPI_APPS_CFG_RCGR_ADDR A:0x61807028
y.create.l HWIO_GCC_BLSP1_QUP6_SPI_APPS_M_ADDR A:0x6180702c
y.create.l HWIO_GCC_BLSP1_QUP6_SPI_APPS_N_ADDR A:0x61807030
y.create.l HWIO_GCC_BLSP1_QUP6_SPI_APPS_D_ADDR A:0x61807034
y.create.l HWIO_GCC_BLSP_UART_SIM_CMD_RCGR_ADDR A:0x6180100c
y.create.l HWIO_GCC_BLSP_UART_SIM_CFG_RCGR_ADDR A:0x61801010
y.create.l HWIO_GCC_PRNG_XPU_CFG_AHB_CBCR_ADDR A:0x61817008
y.create.l HWIO_GCC_PDM_BCR_ADDR A:0x61844000
y.create.l HWIO_GCC_PDM_AHB_CBCR_ADDR A:0x61844004
y.create.l HWIO_GCC_PDM_XO4_CBCR_ADDR A:0x61844008
y.create.l HWIO_GCC_PDM2_CBCR_ADDR A:0x6184400c
y.create.l HWIO_GCC_PDM2_CMD_RCGR_ADDR A:0x61844010
y.create.l HWIO_GCC_PDM2_CFG_RCGR_ADDR A:0x61844014
y.create.l HWIO_GCC_PRNG_BCR_ADDR A:0x61813000
y.create.l HWIO_GCC_PRNG_AHB_CBCR_ADDR A:0x61813004
y.create.l HWIO_GCC_TCSR_BCR_ADDR A:0x61828000
y.create.l HWIO_GCC_TCSR_AHB_CBCR_ADDR A:0x61828004
y.create.l HWIO_GCC_BOOT_ROM_BCR_ADDR A:0x61813008
y.create.l HWIO_GCC_BOOT_ROM_AHB_CBCR_ADDR A:0x6181300c
y.create.l HWIO_GCC_MSG_RAM_BCR_ADDR A:0x6182b000
y.create.l HWIO_GCC_MSG_RAM_AHB_CBCR_ADDR A:0x6182b004
y.create.l HWIO_GCC_TLMM_BCR_ADDR A:0x61834000
y.create.l HWIO_GCC_TLMM_AHB_CBCR_ADDR A:0x61834004
y.create.l HWIO_GCC_TLMM_CBCR_ADDR A:0x61834008
y.create.l HWIO_GCC_MPM_BCR_ADDR A:0x6182c000
y.create.l HWIO_GCC_MPM_MISC_ADDR A:0x6182c004
y.create.l HWIO_GCC_MPM_AHB_CBCR_ADDR A:0x6182c008
y.create.l HWIO_GCC_RPM_PROC_HCLK_CBCR_ADDR A:0x6182d000
y.create.l HWIO_GCC_RPM_BUS_AHB_CBCR_ADDR A:0x6182d004
y.create.l HWIO_GCC_RPM_SLEEP_CBCR_ADDR A:0x6182d008
y.create.l HWIO_GCC_RPM_TIMER_CBCR_ADDR A:0x6182d00c
y.create.l HWIO_GCC_RPM_CMD_RCGR_ADDR A:0x6182d010
y.create.l HWIO_GCC_RPM_CFG_RCGR_ADDR A:0x6182d014
y.create.l HWIO_GCC_RPM_MISC_ADDR A:0x6182d028
y.create.l HWIO_GCC_SEC_CTRL_BCR_ADDR A:0x6181a000
y.create.l HWIO_GCC_ACC_CMD_RCGR_ADDR A:0x6181a004
y.create.l HWIO_GCC_ACC_CFG_RCGR_ADDR A:0x6181a008
y.create.l HWIO_GCC_ACC_MISC_ADDR A:0x6181a01c
y.create.l HWIO_GCC_SEC_CTRL_ACC_CBCR_ADDR A:0x6181a020
y.create.l HWIO_GCC_SEC_CTRL_AHB_CBCR_ADDR A:0x6181a024
y.create.l HWIO_GCC_SEC_CTRL_CBCR_ADDR A:0x6181a028
y.create.l HWIO_GCC_SEC_CTRL_SENSE_CBCR_ADDR A:0x6181a02c
y.create.l HWIO_GCC_SEC_CTRL_BOOT_ROM_PATCH_CBCR_ADDR A:0x6181a030
y.create.l HWIO_GCC_SEC_CTRL_CMD_RCGR_ADDR A:0x6181a034
y.create.l HWIO_GCC_SEC_CTRL_CFG_RCGR_ADDR A:0x6181a038
y.create.l HWIO_GCC_SPMI_BCR_ADDR A:0x6182e000
y.create.l HWIO_GCC_SPMI_SER_CMD_RCGR_ADDR A:0x6182e004
y.create.l HWIO_GCC_SPMI_SER_CFG_RCGR_ADDR A:0x6182e008
y.create.l HWIO_GCC_SPMI_SER_CBCR_ADDR A:0x6182e01c
y.create.l HWIO_GCC_SPMI_PCNOC_AHB_CBCR_ADDR A:0x6182e020
y.create.l HWIO_GCC_SPMI_AHB_CMD_RCGR_ADDR A:0x6182e024
y.create.l HWIO_GCC_SPMI_AHB_CFG_RCGR_ADDR A:0x6182e028
y.create.l HWIO_GCC_SPMI_AHB_CBCR_ADDR A:0x6182e03c
y.create.l HWIO_GCC_SPDM_BCR_ADDR A:0x6182f000
y.create.l HWIO_GCC_SPDM_CFG_AHB_CBCR_ADDR A:0x6182f004
y.create.l HWIO_GCC_SPDM_MSTR_AHB_CBCR_ADDR A:0x6182f008
y.create.l HWIO_GCC_SPDM_FF_CBCR_ADDR A:0x6182f00c
y.create.l HWIO_GCC_SPDM_BIMC_CY_CBCR_ADDR A:0x6182f010
y.create.l HWIO_GCC_SPDM_SNOC_CY_CBCR_ADDR A:0x6182f014
y.create.l HWIO_GCC_SPDM_DEBUG_CY_CBCR_ADDR A:0x6182f018
y.create.l HWIO_GCC_SPDM_PCNOC_CY_CBCR_ADDR A:0x6182f01c
y.create.l HWIO_GCC_SPDM_RPM_CY_CBCR_ADDR A:0x6182f020
y.create.l HWIO_GCC_CRYPTO_BCR_ADDR A:0x61816000
y.create.l HWIO_GCC_CRYPTO_CMD_RCGR_ADDR A:0x61816004
y.create.l HWIO_GCC_CRYPTO_CFG_RCGR_ADDR A:0x61816008
y.create.l HWIO_GCC_CRYPTO_CBCR_ADDR A:0x6181601c
y.create.l HWIO_GCC_CRYPTO_AXI_CBCR_ADDR A:0x61816020
y.create.l HWIO_GCC_CRYPTO_AHB_CBCR_ADDR A:0x61816024
y.create.l HWIO_GCC_GCC_AHB_CBCR_ADDR A:0x61830014
y.create.l HWIO_GCC_GCC_XO_CMD_RCGR_ADDR A:0x61830018
y.create.l HWIO_GCC_GCC_XO_CBCR_ADDR A:0x61830030
y.create.l HWIO_GCC_GCC_XO_DIV4_CBCR_ADDR A:0x61830034
y.create.l HWIO_GCC_GCC_IM_SLEEP_CBCR_ADDR A:0x61830038
y.create.l HWIO_GCC_BIMC_BCR_ADDR A:0x61831000
y.create.l HWIO_GCC_BIMC_GDSCR_ADDR A:0x61831004
y.create.l HWIO_GCC_BIMC_DDR_XO_CMD_RCGR_ADDR A:0x61832000
y.create.l HWIO_GCC_BIMC_XO_CBCR_ADDR A:0x61831008
y.create.l HWIO_GCC_BIMC_CFG_AHB_CBCR_ADDR A:0x6183100c
y.create.l HWIO_GCC_BIMC_SLEEP_CBCR_ADDR A:0x61831010
y.create.l HWIO_GCC_BIMC_SYSNOC_AXI_CBCR_ADDR A:0x61831014
y.create.l HWIO_GCC_BIMC_DDR_CMD_RCGR_ADDR A:0x61832004
y.create.l HWIO_GCC_BIMC_DDR_CFG_RCGR_ADDR A:0x61832008
y.create.l HWIO_GCC_BIMC_MISC_ADDR A:0x61831018
y.create.l HWIO_GCC_BIMC_CBCR_ADDR A:0x6183101c
y.create.l HWIO_GCC_BIMC_APSS_AXI_CBCR_ADDR A:0x61831020
y.create.l HWIO_GCC_DDR_DIM_CFG_CBCR_ADDR A:0x6183201c
y.create.l HWIO_GCC_DDR_DIM_SLEEP_CBCR_ADDR A:0x61832020
y.create.l HWIO_GCC_APSS_TCU_CMD_RCGR_ADDR A:0x61837000
y.create.l HWIO_GCC_APSS_TCU_CFG_RCGR_ADDR A:0x61837004
y.create.l HWIO_GCC_BIMC_GPU_CMD_RCGR_ADDR A:0x61831028
y.create.l HWIO_GCC_BIMC_GPU_CFG_RCGR_ADDR A:0x6183102c
y.create.l HWIO_GCC_BIMC_GPU_CBCR_ADDR A:0x61831040
y.create.l HWIO_GCC_BIMC_TCU_CBCR_ADDR A:0x61831044
y.create.l HWIO_GCC_ULTAUDIO_PCNOC_MPORT_CBCR_ADDR A:0x6181c000
y.create.l HWIO_GCC_ULTAUDIO_PCNOC_SWAY_CBCR_ADDR A:0x6181c004
y.create.l HWIO_GCC_ULT_AUDIO_BCR_ADDR A:0x6181c0b4
y.create.l HWIO_GCC_APSS_AHB_CMD_RCGR_ADDR A:0x61846000
y.create.l HWIO_GCC_APSS_AHB_CFG_RCGR_ADDR A:0x61846004
y.create.l HWIO_GCC_APSS_AHB_MISC_ADDR A:0x61846018
y.create.l HWIO_GCC_APSS_AHB_CBCR_ADDR A:0x6184601c
y.create.l HWIO_GCC_APSS_AXI_CBCR_ADDR A:0x61846020
y.create.l HWIO_GCC_SNOC_BUS_TIMEOUT0_BCR_ADDR A:0x61847000
y.create.l HWIO_GCC_SNOC_BUS_TIMEOUT0_AHB_CBCR_ADDR A:0x61847004
y.create.l HWIO_GCC_PCNOC_BUS_TIMEOUT0_BCR_ADDR A:0x61848000
y.create.l HWIO_GCC_PCNOC_BUS_TIMEOUT0_AHB_CBCR_ADDR A:0x61848004
y.create.l HWIO_GCC_PCNOC_BUS_TIMEOUT1_BCR_ADDR A:0x61848008
y.create.l HWIO_GCC_PCNOC_BUS_TIMEOUT1_AHB_CBCR_ADDR A:0x6184800c
y.create.l HWIO_GCC_PCNOC_BUS_TIMEOUT2_BCR_ADDR A:0x61848010
y.create.l HWIO_GCC_PCNOC_BUS_TIMEOUT2_AHB_CBCR_ADDR A:0x61848014
y.create.l HWIO_GCC_PCNOC_BUS_TIMEOUT3_BCR_ADDR A:0x61848018
y.create.l HWIO_GCC_PCNOC_BUS_TIMEOUT3_AHB_CBCR_ADDR A:0x6184801c
y.create.l HWIO_GCC_PCNOC_BUS_TIMEOUT4_BCR_ADDR A:0x61848020
y.create.l HWIO_GCC_PCNOC_BUS_TIMEOUT4_AHB_CBCR_ADDR A:0x61848024
y.create.l HWIO_GCC_PCNOC_BUS_TIMEOUT5_BCR_ADDR A:0x61848028
y.create.l HWIO_GCC_PCNOC_BUS_TIMEOUT5_AHB_CBCR_ADDR A:0x6184802c
y.create.l HWIO_GCC_PCNOC_BUS_TIMEOUT6_BCR_ADDR A:0x61848030
y.create.l HWIO_GCC_PCNOC_BUS_TIMEOUT6_AHB_CBCR_ADDR A:0x61848034
y.create.l HWIO_GCC_PCNOC_BUS_TIMEOUT7_BCR_ADDR A:0x61848038
y.create.l HWIO_GCC_PCNOC_BUS_TIMEOUT7_AHB_CBCR_ADDR A:0x6184803c
y.create.l HWIO_GCC_PCNOC_BUS_TIMEOUT8_BCR_ADDR A:0x61848040
y.create.l HWIO_GCC_PCNOC_BUS_TIMEOUT8_AHB_CBCR_ADDR A:0x61848044
y.create.l HWIO_GCC_PCNOC_BUS_TIMEOUT9_BCR_ADDR A:0x61848048
y.create.l HWIO_GCC_PCNOC_BUS_TIMEOUT9_AHB_CBCR_ADDR A:0x6184804c
y.create.l HWIO_GCC_DEHR_BCR_ADDR A:0x6181f000
y.create.l HWIO_GCC_DEHR_CBCR_ADDR A:0x6181f004
y.create.l HWIO_GCC_PCNOC_MPU_CFG_AHB_CBCR_ADDR A:0x6181700c
y.create.l HWIO_GCC_GFX_TBU_CBCR_ADDR A:0x61812010
y.create.l HWIO_GCC_VENUS_TBU_CBCR_ADDR A:0x61812014
y.create.l HWIO_GCC_APSS_TCU_ASYNC_CBCR_ADDR A:0x61812098
y.create.l HWIO_GCC_APSS_TCU_CBCR_ADDR A:0x61812018
y.create.l HWIO_GCC_MDP_TBU_CBCR_ADDR A:0x6181201c
y.create.l HWIO_GCC_GFX_TCU_CBCR_ADDR A:0x61812020
y.create.l HWIO_GCC_MSS_TBU_AXI_CBCR_ADDR A:0x61812024
y.create.l HWIO_GCC_MSS_TBU_GSS_AXI_CBCR_ADDR A:0x61812028
y.create.l HWIO_GCC_MSS_TBU_Q6_AXI_CBCR_ADDR A:0x6181202c
y.create.l HWIO_GCC_PCNOC_TBU_CBCR_ADDR A:0x61812030
y.create.l HWIO_GCC_PRONTO_TBU_CBCR_ADDR A:0x61812048
y.create.l HWIO_GCC_SMMU_CFG_CBCR_ADDR A:0x61812038
y.create.l HWIO_GCC_VFE_TBU_CBCR_ADDR A:0x6181203c
y.create.l HWIO_GCC_SMMU_XPU_CBCR_ADDR A:0x61817010
y.create.l HWIO_GCC_GTCU_AHB_CBCR_ADDR A:0x61812044
y.create.l HWIO_GCC_SMMU_CATS_CBCR_ADDR A:0x6187c004
y.create.l HWIO_GCC_SMMU_CATS_BCR_ADDR A:0x6187c000
y.create.l HWIO_GCC_SMMU_BCR_ADDR A:0x61812000
y.create.l HWIO_GCC_APSS_TCU_BCR_ADDR A:0x61812050
y.create.l HWIO_GCC_MDP_TBU_BCR_ADDR A:0x61862000
y.create.l HWIO_GCC_GFX_TBU_BCR_ADDR A:0x61863000
y.create.l HWIO_GCC_GFX_TCU_BCR_ADDR A:0x61864000
y.create.l HWIO_GCC_MSS_TBU_AXI_BCR_ADDR A:0x61865000
y.create.l HWIO_GCC_MSS_TBU_Q6_AXI_BCR_ADDR A:0x61867000
y.create.l HWIO_GCC_MSS_TBU_GSS_AXI_BCR_ADDR A:0x61866000
y.create.l HWIO_GCC_GTCU_AHB_BCR_ADDR A:0x61868000
y.create.l HWIO_GCC_SMMU_XPU_BCR_ADDR A:0x61812054
y.create.l HWIO_GCC_SMMU_CFG_BCR_ADDR A:0x6181208c
y.create.l HWIO_GCC_VFE_TBU_BCR_ADDR A:0x6186a000
y.create.l HWIO_GCC_VENUS_TBU_BCR_ADDR A:0x6186b000
y.create.l HWIO_GCC_PRONTO_TBU_BCR_ADDR A:0x6186d000
y.create.l HWIO_GCC_PCNOC_TBU_BCR_ADDR A:0x61812058
y.create.l HWIO_GCC_RBCPR_BCR_ADDR A:0x61833000
y.create.l HWIO_GCC_RBCPR_CBCR_ADDR A:0x61833004
y.create.l HWIO_GCC_RBCPR_AHB_CBCR_ADDR A:0x61833008
y.create.l HWIO_GCC_RBCPR_CMD_RCGR_ADDR A:0x6183300c
y.create.l HWIO_GCC_RBCPR_CFG_RCGR_ADDR A:0x61833010
y.create.l HWIO_GCC_RPM_GPLL_ENA_VOTE_ADDR A:0x61836000
y.create.l HWIO_GCC_RPM_CLOCK_BRANCH_ENA_VOTE_ADDR A:0x61836004
y.create.l HWIO_GCC_RPM_SMMU_CLOCK_BRANCH_ENA_VOTE_ADDR A:0x6183600c
y.create.l HWIO_GCC_RPM_CLOCK_SLEEP_ENA_VOTE_ADDR A:0x61836008
y.create.l HWIO_GCC_RPM_SMMU_CLOCK_SLEEP_ENA_VOTE_ADDR A:0x61836010
y.create.l HWIO_GCC_APCS_GPLL_ENA_VOTE_ADDR A:0x61845000
y.create.l HWIO_GCC_APCS_CLOCK_BRANCH_ENA_VOTE_ADDR A:0x61845004
y.create.l HWIO_GCC_APCS_SMMU_CLOCK_BRANCH_ENA_VOTE_ADDR A:0x6184500c
y.create.l HWIO_GCC_APCS_CLOCK_SLEEP_ENA_VOTE_ADDR A:0x61845008
y.create.l HWIO_GCC_APCS_SMMU_CLOCK_SLEEP_ENA_VOTE_ADDR A:0x61845010
y.create.l HWIO_GCC_APCS_TZ_GPLL_ENA_VOTE_ADDR A:0x61813010
y.create.l HWIO_GCC_APCS_TZ_CLOCK_BRANCH_ENA_VOTE_ADDR A:0x61813014
y.create.l HWIO_GCC_APCS_TZ_SMMU_CLOCK_BRANCH_ENA_VOTE_ADDR A:0x61813020
y.create.l HWIO_GCC_APCS_TZ_CLOCK_SLEEP_ENA_VOTE_ADDR A:0x61813018
y.create.l HWIO_GCC_APCS_TZ_SMMU_CLOCK_SLEEP_ENA_VOTE_ADDR A:0x61813024
y.create.l HWIO_GCC_APCS_HYP_GPLL_ENA_VOTE_ADDR A:0x61861000
y.create.l HWIO_GCC_APCS_HYP_CLOCK_BRANCH_ENA_VOTE_ADDR A:0x61861004
y.create.l HWIO_GCC_APCS_HYP_SMMU_CLOCK_BRANCH_ENA_VOTE_ADDR A:0x6186100c
y.create.l HWIO_GCC_APCS_HYP_CLOCK_SLEEP_ENA_VOTE_ADDR A:0x61861008
y.create.l HWIO_GCC_APCS_HYP_SMMU_CLOCK_SLEEP_ENA_VOTE_ADDR A:0x61861010
y.create.l HWIO_GCC_MSS_Q6_GPLL_ENA_VOTE_ADDR A:0x6181b000
y.create.l HWIO_GCC_MSS_Q6_CLOCK_BRANCH_ENA_VOTE_ADDR A:0x6181b004
y.create.l HWIO_GCC_MSS_Q6_CLOCK_SLEEP_ENA_VOTE_ADDR A:0x6181b008
y.create.l HWIO_GCC_WCSS_GPLL_ENA_VOTE_ADDR A:0x61870000
y.create.l HWIO_GCC_WCSS_CLOCK_BRANCH_ENA_VOTE_ADDR A:0x61870004
y.create.l HWIO_GCC_WCSS_CLOCK_SLEEP_ENA_VOTE_ADDR A:0x61870008
y.create.l HWIO_GCC_SPARE_GPLL_ENA_VOTE_ADDR A:0x61800000
y.create.l HWIO_GCC_SPARE_CLOCK_BRANCH_ENA_VOTE_ADDR A:0x61800004
y.create.l HWIO_GCC_MSS_RESTART_ADDR A:0x6183e000
y.create.l HWIO_GCC_VENUS_RESTART_ADDR A:0x61810004
y.create.l HWIO_GCC_WCSS_RESTART_ADDR A:0x61811000
y.create.l HWIO_GCC_RESET_DEBUG_ADDR A:0x61814000
y.create.l HWIO_GCC_FLUSH_ETR_DEBUG_TIMER_ADDR A:0x61815000
y.create.l HWIO_GCC_STOP_CAPTURE_DEBUG_TIMER_ADDR A:0x61815004
y.create.l HWIO_GCC_RESET_STATUS_ADDR A:0x61815008
y.create.l HWIO_GCC_SW_SRST_ADDR A:0x6181500c
y.create.l HWIO_GCC_PROC_HALT_ADDR A:0x6181301c
y.create.l HWIO_GCC_GCC_DEBUG_CLK_CTL_ADDR A:0x61874000
y.create.l HWIO_GCC_CLOCK_FRQ_MEASURE_CTL_ADDR A:0x61874004
y.create.l HWIO_GCC_CLOCK_FRQ_MEASURE_STATUS_ADDR A:0x61874008
y.create.l HWIO_GCC_PLLTEST_PAD_CFG_ADDR A:0x6187400c
y.create.l HWIO_GCC_JITTER_PROBE_CFG_ADDR A:0x61874010
y.create.l HWIO_GCC_JITTER_PROBE_VAL_ADDR A:0x61874014
y.create.l HWIO_GCC_GP1_CBCR_ADDR A:0x61808000
y.create.l HWIO_GCC_GP1_CMD_RCGR_ADDR A:0x61808004
y.create.l HWIO_GCC_GP1_CFG_RCGR_ADDR A:0x61808008
y.create.l HWIO_GCC_GP1_M_ADDR A:0x6180800c
y.create.l HWIO_GCC_GP1_N_ADDR A:0x61808010
y.create.l HWIO_GCC_GP1_D_ADDR A:0x61808014
y.create.l HWIO_GCC_GP2_CBCR_ADDR A:0x61809000
y.create.l HWIO_GCC_GP2_CMD_RCGR_ADDR A:0x61809004
y.create.l HWIO_GCC_GP2_CFG_RCGR_ADDR A:0x61809008
y.create.l HWIO_GCC_GP2_M_ADDR A:0x6180900c
y.create.l HWIO_GCC_GP2_N_ADDR A:0x61809010
y.create.l HWIO_GCC_GP2_D_ADDR A:0x61809014
y.create.l HWIO_GCC_GP3_CBCR_ADDR A:0x6180a000
y.create.l HWIO_GCC_GP3_CMD_RCGR_ADDR A:0x6180a004
y.create.l HWIO_GCC_GP3_CFG_RCGR_ADDR A:0x6180a008
y.create.l HWIO_GCC_GP3_M_ADDR A:0x6180a00c
y.create.l HWIO_GCC_GP3_N_ADDR A:0x6180a010
y.create.l HWIO_GCC_GP3_D_ADDR A:0x6180a014
y.create.l HWIO_GCC_APSS_MISC_ADDR A:0x61860000
y.create.l HWIO_GCC_TIC_MODE_APSS_BOOT_ADDR A:0x6187f000
y.create.l HWIO_GCC_USB_BOOT_CLOCK_CTL_ADDR A:0x61840000
y.create.l HWIO_GCC_RAW_SLEEP_CLK_CTRL_ADDR A:0x61835000
y.create.l HWIO_GCC_S1LM_MODEM_DIV_VOTE_ADDR A:0x61800008
y.create.l HWIO_GCC_GCC_SPARE1_REG_ADDR A:0x6180000c
y.create.l HWIO_GCC_S1LM_APPS_DIV_VOTE_ADDR A:0x6187e000
y.create.l HWIO_GCC_GCC_SPARE3_REG_ADDR A:0x6187e004
y.create.l HWIO_GCC_DCD_BCR_ADDR A:0x6182a000
y.create.l HWIO_GCC_DCD_XO_CBCR_ADDR A:0x6182a004
y.create.l HWIO_GCC_SNOC_DCD_CONFIG_ADDR A:0x6182a008
y.create.l HWIO_GCC_SNOC_DCD_HYSTERESIS_CNT_ADDR A:0x6182a00c
y.create.l HWIO_GCC_PCNOC_DCD_CONFIG_ADDR A:0x6182a010
y.create.l HWIO_GCC_PCNOC_DCD_HYSTERESIS_CNT_ADDR A:0x6182a014
y.create.l HWIO_GCC_MM_SPDM_BCR_ADDR A:0x6182f024
y.create.l HWIO_GCC_SPDM_MDP_CBCR_ADDR A:0x6182f02c
y.create.l HWIO_GCC_SPDM_VCODEC0_CBCR_ADDR A:0x6182f034
y.create.l HWIO_GCC_SPDM_VFE0_CBCR_ADDR A:0x6182f038
y.create.l HWIO_GCC_SPDM_GFX3D_CBCR_ADDR A:0x6182f03c
y.create.l HWIO_GCC_SPDM_AHB_CBCR_ADDR A:0x6182f040
y.create.l HWIO_GCC_SPDM_PCLK0_CBCR_ADDR A:0x6182f044
y.create.l HWIO_GCC_SPDM_CSI0_CBCR_ADDR A:0x6182f048
y.create.l HWIO_GCC_VCODEC0_CMD_RCGR_ADDR A:0x6184c000
y.create.l HWIO_GCC_VCODEC0_CFG_RCGR_ADDR A:0x6184c004
y.create.l HWIO_GCC_VCODEC0_M_ADDR A:0x6184c008
y.create.l HWIO_GCC_VCODEC0_N_ADDR A:0x6184c00c
y.create.l HWIO_GCC_VCODEC0_D_ADDR A:0x6184c010
y.create.l HWIO_GCC_VENUS0_BCR_ADDR A:0x6184c014
y.create.l HWIO_GCC_VENUS0_GDSCR_ADDR A:0x6184c018
y.create.l HWIO_GCC_VENUS0_CORE0_GDSCR_ADDR A:0x6184c028
y.create.l HWIO_GCC_VENUS0_VCODEC0_CBCR_ADDR A:0x6184c01c
y.create.l HWIO_GCC_VENUS0_CORE0_VCODEC0_CBCR_ADDR A:0x6184c02c
y.create.l HWIO_GCC_VENUS0_AHB_CBCR_ADDR A:0x6184c020
y.create.l HWIO_GCC_VENUS0_AXI_CBCR_ADDR A:0x6184c024
y.create.l HWIO_GCC_PCLK0_CMD_RCGR_ADDR A:0x6184d000
y.create.l HWIO_GCC_PCLK0_CFG_RCGR_ADDR A:0x6184d004
y.create.l HWIO_GCC_PCLK0_M_ADDR A:0x6184d008
y.create.l HWIO_GCC_PCLK0_N_ADDR A:0x6184d00c
y.create.l HWIO_GCC_PCLK0_D_ADDR A:0x6184d010
y.create.l HWIO_GCC_MDP_CMD_RCGR_ADDR A:0x6184d014
y.create.l HWIO_GCC_MDP_CFG_RCGR_ADDR A:0x6184d018
y.create.l HWIO_GCC_VSYNC_CMD_RCGR_ADDR A:0x6184d02c
y.create.l HWIO_GCC_VSYNC_CFG_RCGR_ADDR A:0x6184d030
y.create.l HWIO_GCC_BYTE0_CMD_RCGR_ADDR A:0x6184d044
y.create.l HWIO_GCC_BYTE0_CFG_RCGR_ADDR A:0x6184d048
y.create.l HWIO_GCC_ESC0_CMD_RCGR_ADDR A:0x6184d05c
y.create.l HWIO_GCC_ESC0_CFG_RCGR_ADDR A:0x6184d060
y.create.l HWIO_GCC_MDSS_BCR_ADDR A:0x6184d074
y.create.l HWIO_GCC_MDSS_GDSCR_ADDR A:0x6184d078
y.create.l HWIO_GCC_MDSS_AHB_CBCR_ADDR A:0x6184d07c
y.create.l HWIO_GCC_MDSS_AXI_CBCR_ADDR A:0x6184d080
y.create.l HWIO_GCC_MDSS_PCLK0_CBCR_ADDR A:0x6184d084
y.create.l HWIO_GCC_MDSS_MDP_CBCR_ADDR A:0x6184d088
y.create.l HWIO_GCC_MDSS_VSYNC_CBCR_ADDR A:0x6184d090
y.create.l HWIO_GCC_MDSS_BYTE0_CBCR_ADDR A:0x6184d094
y.create.l HWIO_GCC_MDSS_ESC0_CBCR_ADDR A:0x6184d098
y.create.l HWIO_GCC_CSI0PHYTIMER_CMD_RCGR_ADDR A:0x6184e000
y.create.l HWIO_GCC_CSI0PHYTIMER_CFG_RCGR_ADDR A:0x6184e004
y.create.l HWIO_GCC_CAMSS_PHY0_BCR_ADDR A:0x6184e018
y.create.l HWIO_GCC_CAMSS_PHY0_CSI0PHYTIMER_CBCR_ADDR A:0x6184e01c
y.create.l HWIO_GCC_CSI0_CMD_RCGR_ADDR A:0x6184e020
y.create.l HWIO_GCC_CSI0_CFG_RCGR_ADDR A:0x6184e024
y.create.l HWIO_GCC_CAMSS_CSI0_BCR_ADDR A:0x6184e038
y.create.l HWIO_GCC_CAMSS_CSI0_CBCR_ADDR A:0x6184e03c
y.create.l HWIO_GCC_CAMSS_CSI0_AHB_CBCR_ADDR A:0x6184e040
y.create.l HWIO_GCC_CAMSS_CSI0PHY_BCR_ADDR A:0x6184e044
y.create.l HWIO_GCC_CAMSS_CSI0PHY_CBCR_ADDR A:0x6184e048
y.create.l HWIO_GCC_CAMSS_CSI0RDI_BCR_ADDR A:0x6184e04c
y.create.l HWIO_GCC_CAMSS_CSI0RDI_CBCR_ADDR A:0x6184e050
y.create.l HWIO_GCC_CAMSS_CSI0PIX_BCR_ADDR A:0x6184e054
y.create.l HWIO_GCC_CAMSS_CSI0PIX_CBCR_ADDR A:0x6184e058
y.create.l HWIO_GCC_CSI1_CMD_RCGR_ADDR A:0x6184f020
y.create.l HWIO_GCC_CSI1_CFG_RCGR_ADDR A:0x6184f024
y.create.l HWIO_GCC_CAMSS_CSI1_BCR_ADDR A:0x6184f038
y.create.l HWIO_GCC_CAMSS_CSI1_CBCR_ADDR A:0x6184f03c
y.create.l HWIO_GCC_CAMSS_CSI1_AHB_CBCR_ADDR A:0x6184f040
y.create.l HWIO_GCC_CAMSS_CSI1PHY_BCR_ADDR A:0x6184f044
y.create.l HWIO_GCC_CAMSS_CSI1PHY_CBCR_ADDR A:0x6184f048
y.create.l HWIO_GCC_CAMSS_CSI1RDI_BCR_ADDR A:0x6184f04c
y.create.l HWIO_GCC_CAMSS_CSI1RDI_CBCR_ADDR A:0x6184f050
y.create.l HWIO_GCC_CAMSS_CSI1PIX_BCR_ADDR A:0x6184f054
y.create.l HWIO_GCC_CAMSS_CSI1PIX_CBCR_ADDR A:0x6184f058
y.create.l HWIO_GCC_CAMSS_ISPIF_BCR_ADDR A:0x61850000
y.create.l HWIO_GCC_CAMSS_ISPIF_AHB_CBCR_ADDR A:0x61850004
y.create.l HWIO_GCC_MCLK0_CMD_RCGR_ADDR A:0x61852000
y.create.l HWIO_GCC_MCLK0_CFG_RCGR_ADDR A:0x61852004
y.create.l HWIO_GCC_MCLK0_M_ADDR A:0x61852008
y.create.l HWIO_GCC_MCLK0_N_ADDR A:0x6185200c
y.create.l HWIO_GCC_MCLK0_D_ADDR A:0x61852010
y.create.l HWIO_GCC_CAMSS_MCLK0_BCR_ADDR A:0x61852014
y.create.l HWIO_GCC_CAMSS_MCLK0_CBCR_ADDR A:0x61852018
y.create.l HWIO_GCC_MCLK1_CMD_RCGR_ADDR A:0x61853000
y.create.l HWIO_GCC_MCLK1_CFG_RCGR_ADDR A:0x61853004
y.create.l HWIO_GCC_MCLK1_M_ADDR A:0x61853008
y.create.l HWIO_GCC_MCLK1_N_ADDR A:0x6185300c
y.create.l HWIO_GCC_MCLK1_D_ADDR A:0x61853010
y.create.l HWIO_GCC_CAMSS_MCLK1_BCR_ADDR A:0x61853014
y.create.l HWIO_GCC_CAMSS_MCLK1_CBCR_ADDR A:0x61853018
y.create.l HWIO_GCC_MM_GP0_CMD_RCGR_ADDR A:0x61854000
y.create.l HWIO_GCC_MM_GP0_CFG_RCGR_ADDR A:0x61854004
y.create.l HWIO_GCC_MM_GP0_M_ADDR A:0x61854008
y.create.l HWIO_GCC_MM_GP0_N_ADDR A:0x6185400c
y.create.l HWIO_GCC_MM_GP0_D_ADDR A:0x61854010
y.create.l HWIO_GCC_CAMSS_GP0_BCR_ADDR A:0x61854014
y.create.l HWIO_GCC_CAMSS_GP0_CBCR_ADDR A:0x61854018
y.create.l HWIO_GCC_MM_GP1_CMD_RCGR_ADDR A:0x61855000
y.create.l HWIO_GCC_MM_GP1_CFG_RCGR_ADDR A:0x61855004
y.create.l HWIO_GCC_MM_GP1_M_ADDR A:0x61855008
y.create.l HWIO_GCC_MM_GP1_N_ADDR A:0x6185500c
y.create.l HWIO_GCC_MM_GP1_D_ADDR A:0x61855010
y.create.l HWIO_GCC_CAMSS_GP1_BCR_ADDR A:0x61855014
y.create.l HWIO_GCC_CAMSS_GP1_CBCR_ADDR A:0x61855018
y.create.l HWIO_GCC_CAMSS_TOP_BCR_ADDR A:0x61856000
y.create.l HWIO_GCC_CAMSS_TOP_AHB_CBCR_ADDR A:0x6185a014
y.create.l HWIO_GCC_CAMSS_TOP_AHB_BCR_ADDR A:0x6185a018
y.create.l HWIO_GCC_CAMSS_AHB_CBCR_ADDR A:0x61856004
y.create.l HWIO_GCC_VFE0_CMD_RCGR_ADDR A:0x61858000
y.create.l HWIO_GCC_VFE0_CFG_RCGR_ADDR A:0x61858004
y.create.l HWIO_GCC_CAMSS_VFE_BCR_ADDR A:0x61858030
y.create.l HWIO_GCC_CAMSS_VFE_GDSCR_ADDR A:0x61858034
y.create.l HWIO_GCC_CAMSS_VFE0_CBCR_ADDR A:0x61858038
y.create.l HWIO_GCC_CAMSS_VFE_AHB_CBCR_ADDR A:0x61858044
y.create.l HWIO_GCC_CAMSS_VFE_AXI_CBCR_ADDR A:0x61858048
y.create.l HWIO_GCC_CAMSS_CSI_VFE0_BCR_ADDR A:0x6185804c
y.create.l HWIO_GCC_CAMSS_CSI_VFE0_CBCR_ADDR A:0x61858050
y.create.l HWIO_GCC_GFX3D_CMD_RCGR_ADDR A:0x61859000
y.create.l HWIO_GCC_GFX3D_CFG_RCGR_ADDR A:0x61859004
y.create.l HWIO_GCC_OXILI_BCR_ADDR A:0x61859018
y.create.l HWIO_GCC_OXILI_GDSCR_ADDR A:0x6185901c
y.create.l HWIO_GCC_OXILI_GFX3D_CBCR_ADDR A:0x61859020
y.create.l HWIO_GCC_OXILI_AHB_CBCR_ADDR A:0x61859028
y.create.l HWIO_GCC_CAMSS_TOP_AHB_CMD_RCGR_ADDR A:0x6185a000
y.create.l HWIO_GCC_CAMSS_TOP_AHB_CFG_RCGR_ADDR A:0x6185a004
y.create.l HWIO_GCC_CAMSS_TOP_AHB_M_ADDR A:0x6185a008
y.create.l HWIO_GCC_CAMSS_TOP_AHB_N_ADDR A:0x6185a00c
y.create.l HWIO_GCC_CAMSS_TOP_AHB_D_ADDR A:0x6185a010
y.create.l HWIO_GCC_GX_DOMAIN_MISC_ADDR A:0x6185b00c
y.create.l HWIO_GCC_AUDIO_CORE_BCR_ADDR A:0x6181c008
y.create.l HWIO_GCC_ULTAUDIO_LPAIF_PRI_I2S_CMD_RCGR_ADDR A:0x6181c054
y.create.l HWIO_GCC_ULTAUDIO_LPAIF_PRI_I2S_CFG_RCGR_ADDR A:0x6181c058
y.create.l HWIO_GCC_ULTAUDIO_LPAIF_PRI_I2S_M_ADDR A:0x6181c05c
y.create.l HWIO_GCC_ULTAUDIO_LPAIF_PRI_I2S_N_ADDR A:0x6181c060
y.create.l HWIO_GCC_ULTAUDIO_LPAIF_PRI_I2S_D_ADDR A:0x6181c064
y.create.l HWIO_GCC_ULTAUDIO_LPAIF_PRI_I2S_CBCR_ADDR A:0x6181c068
y.create.l HWIO_GCC_ULTAUDIO_LPAIF_SEC_I2S_CMD_RCGR_ADDR A:0x6181c06c
y.create.l HWIO_GCC_ULTAUDIO_LPAIF_SEC_I2S_CFG_RCGR_ADDR A:0x6181c070
y.create.l HWIO_GCC_ULTAUDIO_LPAIF_SEC_I2S_M_ADDR A:0x6181c074
y.create.l HWIO_GCC_ULTAUDIO_LPAIF_SEC_I2S_N_ADDR A:0x6181c078
y.create.l HWIO_GCC_ULTAUDIO_LPAIF_SEC_I2S_D_ADDR A:0x6181c07c
y.create.l HWIO_GCC_ULTAUDIO_LPAIF_SEC_I2S_CBCR_ADDR A:0x6181c080
y.create.l HWIO_GCC_ULTAUDIO_XO_CMD_RCGR_ADDR A:0x6181c034
y.create.l HWIO_GCC_ULTAUDIO_XO_CFG_RCGR_ADDR A:0x6181c038
y.create.l HWIO_GCC_ULTAUDIO_AHBFABRIC_CMD_RCGR_ADDR A:0x6181c010
y.create.l HWIO_GCC_ULTAUDIO_AHBFABRIC_CFG_RCGR_ADDR A:0x6181c014
y.create.l HWIO_GCC_ULTAUDIO_AHBFABRIC_M_ADDR A:0x6181c018
y.create.l HWIO_GCC_ULTAUDIO_AHBFABRIC_N_ADDR A:0x6181c01c
y.create.l HWIO_GCC_ULTAUDIO_AHBFABRIC_D_ADDR A:0x6181c020
y.create.l HWIO_GCC_ULTAUDIO_AHBFABRIC_IXFABRIC_LPM_CBCR_ADDR A:0x6181c024
y.create.l HWIO_GCC_ULTAUDIO_AHBFABRIC_IXFABRIC_CBCR_ADDR A:0x6181c028
y.create.l HWIO_GCC_ULTAUDIO_AVSYNC_XO_CBCR_ADDR A:0x6181c04c
y.create.l HWIO_GCC_ULTAUDIO_STC_XO_CBCR_ADDR A:0x6181c050
y.create.l HWIO_GCC_ULTAUDIO_AHBFABRIC_EFABRIC_SPDM_CBCR_ADDR A:0x6181c030
y.create.l HWIO_GCC_CODEC_DIGCODEC_CMD_RCGR_ADDR A:0x6181c09c
y.create.l HWIO_GCC_CODEC_DIGCODEC_CFG_RCGR_ADDR A:0x6181c0a0
y.create.l HWIO_GCC_CODEC_DIGCODEC_M_ADDR A:0x6181c0a4
y.create.l HWIO_GCC_CODEC_DIGCODEC_N_ADDR A:0x6181c0a8
y.create.l HWIO_GCC_CODEC_DIGCODEC_D_ADDR A:0x6181c0ac
y.create.l HWIO_GCC_CODEC_DIGCODEC_CBCR_ADDR A:0x6181c0b0
y.create.l HWIO_GCC_ULTAUDIO_LPAIF_AUX_I2S_CMD_RCGR_ADDR A:0x6181c084
y.create.l HWIO_GCC_ULTAUDIO_LPAIF_AUX_I2S_CFG_RCGR_ADDR A:0x6181c088
y.create.l HWIO_GCC_ULTAUDIO_LPAIF_AUX_I2S_M_ADDR A:0x6181c08c
y.create.l HWIO_GCC_ULTAUDIO_LPAIF_AUX_I2S_N_ADDR A:0x6181c090
y.create.l HWIO_GCC_ULTAUDIO_LPAIF_AUX_I2S_D_ADDR A:0x6181c094
y.create.l HWIO_GCC_ULTAUDIO_LPAIF_AUX_I2S_CBCR_ADDR A:0x6181c098
y.create.l HWIO_GCC_ULTAUDIO_PCM_DATA_OE_CMD_RCGR_ADDR A:0x6181c0f0
y.create.l HWIO_GCC_ULTAUDIO_PCM_DATA_OE_CFG_RCGR_ADDR A:0x6181c0f4
y.create.l HWIO_GCC_ULTAUDIO_PCM_DATA_OE_M_ADDR A:0x6181c0f8
y.create.l HWIO_GCC_ULTAUDIO_PCM_DATA_OE_N_ADDR A:0x6181c0fc
y.create.l HWIO_GCC_ULTAUDIO_PCM_DATA_OE_D_ADDR A:0x6181c100
y.create.l HWIO_GCC_ULTAUDIO_PCM_DATA_OE_CBCR_ADDR A:0x6181c104
y.create.l HWIO_GCC_ULTAUDIO_EXT_MCLK2_CMD_RCGR_ADDR A:0x6181c0d8
y.create.l HWIO_GCC_ULTAUDIO_EXT_MCLK2_CFG_RCGR_ADDR A:0x6181c0dc
y.create.l HWIO_GCC_ULTAUDIO_EXT_MCLK2_M_ADDR A:0x6181c0e0
y.create.l HWIO_GCC_ULTAUDIO_EXT_MCLK2_N_ADDR A:0x6181c0e4
y.create.l HWIO_GCC_ULTAUDIO_EXT_MCLK2_D_ADDR A:0x6181c0e8
y.create.l HWIO_GCC_ULTAUDIO_EXT_MCLK2_CBCR_ADDR A:0x6181c0ec
y.create.l HWIO_GCC_AUDIO_REF_CLOCK_SEL_ADDR A:0x6181c0b8
y.create.l HWIO_GCC_RPU_XPU_SCR_ADDR A:0x61880000
y.create.l HWIO_GCC_RPU_XPU_SWDR_ADDR A:0x61880004
y.create.l HWIO_GCC_RPU_XPU_SEAR0_ADDR A:0x61880040
y.create.l HWIO_GCC_RPU_XPU_SESR_ADDR A:0x61880048
y.create.l HWIO_GCC_RPU_XPU_SESRRESTORE_ADDR A:0x6188004c
y.create.l HWIO_GCC_RPU_XPU_SESYNR0_ADDR A:0x61880050
y.create.l HWIO_GCC_RPU_XPU_SESYNR1_ADDR A:0x61880054
y.create.l HWIO_GCC_RPU_XPU_SESYNR2_ADDR A:0x61880058
y.create.l HWIO_GCC_RPU_XPU_MCR_ADDR A:0x61880100
y.create.l HWIO_GCC_RPU_XPU_MEAR0_ADDR A:0x61880140
y.create.l HWIO_GCC_RPU_XPU_MESR_ADDR A:0x61880148
y.create.l HWIO_GCC_RPU_XPU_MESRRESTORE_ADDR A:0x6188014c
y.create.l HWIO_GCC_RPU_XPU_MESYNR0_ADDR A:0x61880150
y.create.l HWIO_GCC_RPU_XPU_MESYNR1_ADDR A:0x61880154
y.create.l HWIO_GCC_RPU_XPU_MESYNR2_ADDR A:0x61880158
y.create.l HWIO_GCC_RPU_XPU_CR_ADDR A:0x61880080
y.create.l HWIO_GCC_RPU_XPU_RPU_ACR0_ADDR A:0x618800a0
y.create.l HWIO_GCC_RPU_XPU_EAR0_ADDR A:0x618800c0
y.create.l HWIO_GCC_RPU_XPU_ESR_ADDR A:0x618800c8
y.create.l HWIO_GCC_RPU_XPU_ESRRESTORE_ADDR A:0x618800cc
y.create.l HWIO_GCC_RPU_XPU_ESYNR0_ADDR A:0x618800d0
y.create.l HWIO_GCC_RPU_XPU_ESYNR1_ADDR A:0x618800d4
y.create.l HWIO_GCC_RPU_XPU_ESYNR2_ADDR A:0x618800d8
y.create.l HWIO_GCC_RPU_XPU_IDR0_ADDR A:0x61880074
y.create.l HWIO_GCC_RPU_XPU_IDR1_ADDR A:0x61880078
y.create.l HWIO_GCC_RPU_XPU_REV_ADDR A:0x6188007c
y.create.l HWIO_GCC_RPU_XPU_RG0_RACR0_ADDR A:0x61880200
y.create.l HWIO_GCC_RPU_XPU_RG1_RACR0_ADDR A:0x61880280
y.create.l HWIO_GCC_RPU_XPU_RG2_RACR0_ADDR A:0x61880300
y.create.l HWIO_GCC_RPU_XPU_RG3_RACR0_ADDR A:0x61880380
y.create.l HWIO_GCC_RPU_XPU_RG4_RACR0_ADDR A:0x61880400
y.create.l HWIO_GCC_RPU_XPU_RG5_RACR0_ADDR A:0x61880480
y.create.l HWIO_GCC_RPU_XPU_RG6_RACR0_ADDR A:0x61880500
y.create.l HWIO_GCC_RPU_XPU_RG7_RACR0_ADDR A:0x61880580
y.create.l HWIO_GCC_RPU_XPU_RG8_RACR0_ADDR A:0x61880600
y.create.l HWIO_GCC_RPU_XPU_RG9_RACR0_ADDR A:0x61880680
y.create.l HWIO_GCC_RPU_XPU_RG0_WACR0_ADDR A:0x61880220
y.create.l HWIO_GCC_RPU_XPU_RG1_WACR0_ADDR A:0x618802a0
y.create.l HWIO_GCC_RPU_XPU_RG2_WACR0_ADDR A:0x61880320
y.create.l HWIO_GCC_RPU_XPU_RG3_WACR0_ADDR A:0x618803a0
y.create.l HWIO_GCC_RPU_XPU_RG4_WACR0_ADDR A:0x61880420
y.create.l HWIO_GCC_RPU_XPU_RG5_WACR0_ADDR A:0x618804a0
y.create.l HWIO_GCC_RPU_XPU_RG6_WACR0_ADDR A:0x61880520
y.create.l HWIO_GCC_RPU_XPU_RG7_WACR0_ADDR A:0x618805a0
y.create.l HWIO_GCC_RPU_XPU_RG8_WACR0_ADDR A:0x61880620
y.create.l HWIO_GCC_RPU_XPU_RG9_WACR0_ADDR A:0x618806a0
y.create.l HWIO_GCC_RPU_XPU_RG0_SCR_ADDR A:0x61880250
y.create.l HWIO_GCC_RPU_XPU_RG1_SCR_ADDR A:0x618802d0
y.create.l HWIO_GCC_RPU_XPU_RG2_SCR_ADDR A:0x61880350
y.create.l HWIO_GCC_RPU_XPU_RG3_SCR_ADDR A:0x618803d0
y.create.l HWIO_GCC_RPU_XPU_RG4_SCR_ADDR A:0x61880450
y.create.l HWIO_GCC_RPU_XPU_RG5_SCR_ADDR A:0x618804d0
y.create.l HWIO_GCC_RPU_XPU_RG6_SCR_ADDR A:0x61880550
y.create.l HWIO_GCC_RPU_XPU_RG7_SCR_ADDR A:0x618805d0
y.create.l HWIO_GCC_RPU_XPU_RG8_SCR_ADDR A:0x61880650
y.create.l HWIO_GCC_RPU_XPU_RG9_SCR_ADDR A:0x618806d0
y.create.l HWIO_GCC_RPU_XPU_RG0_MCR_ADDR A:0x61880254
y.create.l HWIO_GCC_RPU_XPU_RG1_MCR_ADDR A:0x618802d4
y.create.l HWIO_GCC_RPU_XPU_RG2_MCR_ADDR A:0x61880354
y.create.l HWIO_GCC_RPU_XPU_RG3_MCR_ADDR A:0x618803d4
y.create.l HWIO_GCC_RPU_XPU_RG4_MCR_ADDR A:0x61880454
y.create.l HWIO_GCC_RPU_XPU_RG5_MCR_ADDR A:0x618804d4
y.create.l HWIO_GCC_RPU_XPU_RG6_MCR_ADDR A:0x61880554
y.create.l HWIO_GCC_RPU_XPU_RG7_MCR_ADDR A:0x618805d4
y.create.l HWIO_GCC_RPU_XPU_RG8_MCR_ADDR A:0x61880654
y.create.l HWIO_GCC_RPU_XPU_RG9_MCR_ADDR A:0x618806d4
y.create.l HWIO_TCSR_MUTEX_REG_0_ADDR A:0x61905000
y.create.l HWIO_TCSR_MUTEX_REG_1_ADDR A:0x61906000
y.create.l HWIO_TCSR_MUTEX_REG_2_ADDR A:0x61907000
y.create.l HWIO_TCSR_MUTEX_REG_3_ADDR A:0x61908000
y.create.l HWIO_TCSR_MUTEX_REG_4_ADDR A:0x61909000
y.create.l HWIO_TCSR_MUTEX_REG_5_ADDR A:0x6190a000
y.create.l HWIO_TCSR_MUTEX_REG_6_ADDR A:0x6190b000
y.create.l HWIO_TCSR_MUTEX_REG_7_ADDR A:0x6190c000
y.create.l HWIO_TCSR_MUTEX_REG_8_ADDR A:0x6190d000
y.create.l HWIO_TCSR_MUTEX_REG_9_ADDR A:0x6190e000
y.create.l HWIO_TCSR_REGS_XPU_SCR_ADDR A:0x61936000
y.create.l HWIO_TCSR_REGS_XPU_SWDR_ADDR A:0x61936004
y.create.l HWIO_TCSR_REGS_XPU_SEAR0_ADDR A:0x61936040
y.create.l HWIO_TCSR_REGS_XPU_SESR_ADDR A:0x61936048
y.create.l HWIO_TCSR_REGS_XPU_SESRRESTORE_ADDR A:0x6193604c
y.create.l HWIO_TCSR_REGS_XPU_SESYNR0_ADDR A:0x61936050
y.create.l HWIO_TCSR_REGS_XPU_SESYNR1_ADDR A:0x61936054
y.create.l HWIO_TCSR_REGS_XPU_SESYNR2_ADDR A:0x61936058
y.create.l HWIO_TCSR_REGS_XPU_MCR_ADDR A:0x61936100
y.create.l HWIO_TCSR_REGS_XPU_MEAR0_ADDR A:0x61936140
y.create.l HWIO_TCSR_REGS_XPU_MESR_ADDR A:0x61936148
y.create.l HWIO_TCSR_REGS_XPU_MESRRESTORE_ADDR A:0x6193614c
y.create.l HWIO_TCSR_REGS_XPU_MESYNR0_ADDR A:0x61936150
y.create.l HWIO_TCSR_REGS_XPU_MESYNR1_ADDR A:0x61936154
y.create.l HWIO_TCSR_REGS_XPU_MESYNR2_ADDR A:0x61936158
y.create.l HWIO_TCSR_REGS_XPU_CR_ADDR A:0x61936080
y.create.l HWIO_TCSR_REGS_XPU_RPU_ACR0_ADDR A:0x619360a0
y.create.l HWIO_TCSR_REGS_XPU_EAR0_ADDR A:0x619360c0
y.create.l HWIO_TCSR_REGS_XPU_ESR_ADDR A:0x619360c8
y.create.l HWIO_TCSR_REGS_XPU_ESRRESTORE_ADDR A:0x619360cc
y.create.l HWIO_TCSR_REGS_XPU_ESYNR0_ADDR A:0x619360d0
y.create.l HWIO_TCSR_REGS_XPU_ESYNR1_ADDR A:0x619360d4
y.create.l HWIO_TCSR_REGS_XPU_ESYNR2_ADDR A:0x619360d8
y.create.l HWIO_TCSR_REGS_XPU_IDR0_ADDR A:0x61936074
y.create.l HWIO_TCSR_REGS_XPU_IDR1_ADDR A:0x61936078
y.create.l HWIO_TCSR_REGS_XPU_REV_ADDR A:0x6193607c
y.create.l HWIO_TCSR_REGS_XPU_RG0_RACR0_ADDR A:0x61936200
y.create.l HWIO_TCSR_REGS_XPU_RG1_RACR0_ADDR A:0x61936280
y.create.l HWIO_TCSR_REGS_XPU_RG2_RACR0_ADDR A:0x61936300
y.create.l HWIO_TCSR_REGS_XPU_RG3_RACR0_ADDR A:0x61936380
y.create.l HWIO_TCSR_REGS_XPU_RG4_RACR0_ADDR A:0x61936400
y.create.l HWIO_TCSR_REGS_XPU_RG5_RACR0_ADDR A:0x61936480
y.create.l HWIO_TCSR_REGS_XPU_RG6_RACR0_ADDR A:0x61936500
y.create.l HWIO_TCSR_REGS_XPU_RG7_RACR0_ADDR A:0x61936580
y.create.l HWIO_TCSR_REGS_XPU_RG8_RACR0_ADDR A:0x61936600
y.create.l HWIO_TCSR_REGS_XPU_RG9_RACR0_ADDR A:0x61936680
y.create.l HWIO_TCSR_REGS_XPU_RG0_WACR0_ADDR A:0x61936220
y.create.l HWIO_TCSR_REGS_XPU_RG1_WACR0_ADDR A:0x619362a0
y.create.l HWIO_TCSR_REGS_XPU_RG2_WACR0_ADDR A:0x61936320
y.create.l HWIO_TCSR_REGS_XPU_RG3_WACR0_ADDR A:0x619363a0
y.create.l HWIO_TCSR_REGS_XPU_RG4_WACR0_ADDR A:0x61936420
y.create.l HWIO_TCSR_REGS_XPU_RG5_WACR0_ADDR A:0x619364a0
y.create.l HWIO_TCSR_REGS_XPU_RG6_WACR0_ADDR A:0x61936520
y.create.l HWIO_TCSR_REGS_XPU_RG7_WACR0_ADDR A:0x619365a0
y.create.l HWIO_TCSR_REGS_XPU_RG8_WACR0_ADDR A:0x61936620
y.create.l HWIO_TCSR_REGS_XPU_RG9_WACR0_ADDR A:0x619366a0
y.create.l HWIO_TCSR_REGS_XPU_RG0_SCR_ADDR A:0x61936250
y.create.l HWIO_TCSR_REGS_XPU_RG1_SCR_ADDR A:0x619362d0
y.create.l HWIO_TCSR_REGS_XPU_RG2_SCR_ADDR A:0x61936350
y.create.l HWIO_TCSR_REGS_XPU_RG3_SCR_ADDR A:0x619363d0
y.create.l HWIO_TCSR_REGS_XPU_RG4_SCR_ADDR A:0x61936450
y.create.l HWIO_TCSR_REGS_XPU_RG5_SCR_ADDR A:0x619364d0
y.create.l HWIO_TCSR_REGS_XPU_RG6_SCR_ADDR A:0x61936550
y.create.l HWIO_TCSR_REGS_XPU_RG7_SCR_ADDR A:0x619365d0
y.create.l HWIO_TCSR_REGS_XPU_RG8_SCR_ADDR A:0x61936650
y.create.l HWIO_TCSR_REGS_XPU_RG9_SCR_ADDR A:0x619366d0
y.create.l HWIO_TCSR_REGS_XPU_RG0_MCR_ADDR A:0x61936254
y.create.l HWIO_TCSR_REGS_XPU_RG1_MCR_ADDR A:0x619362d4
y.create.l HWIO_TCSR_REGS_XPU_RG2_MCR_ADDR A:0x61936354
y.create.l HWIO_TCSR_REGS_XPU_RG3_MCR_ADDR A:0x619363d4
y.create.l HWIO_TCSR_REGS_XPU_RG4_MCR_ADDR A:0x61936454
y.create.l HWIO_TCSR_REGS_XPU_RG5_MCR_ADDR A:0x619364d4
y.create.l HWIO_TCSR_REGS_XPU_RG6_MCR_ADDR A:0x61936554
y.create.l HWIO_TCSR_REGS_XPU_RG7_MCR_ADDR A:0x619365d4
y.create.l HWIO_TCSR_REGS_XPU_RG8_MCR_ADDR A:0x61936654
y.create.l HWIO_TCSR_REGS_XPU_RG9_MCR_ADDR A:0x619366d4
y.create.l HWIO_TCSR_BIMC_CFG_QRIB_XPU2_INIT_ADDR A:0x61937100
y.create.l HWIO_TCSR_BIMC_QXS0_QRIB_XPU2_INIT_ADDR A:0x61937104
y.create.l HWIO_TCSR_MMSS_VENUS0_VBIF_QRIB_XPU2_INIT_ADDR A:0x61937380
y.create.l HWIO_TCSR_MMSS_VENUS0_WRAPPER_QRIB_XPU2_INIT_ADDR A:0x61937384
y.create.l HWIO_TCSR_BIMC_CFG_QRIB_XPU2_ACR_ADDR A:0x61938000
y.create.l HWIO_TCSR_BIMC_CFG_QRIB_XPU2_VMIDEN_INIT_ADDR A:0x61938004
y.create.l HWIO_TCSR_BIMC_QXS0_QRIB_XPU2_ACR_ADDR A:0x61938008
y.create.l HWIO_TCSR_BIMC_QXS0_QRIB_XPU2_VMIDEN_INIT_ADDR A:0x6193800c
y.create.l HWIO_TCSR_MMSS_VENUS0_VBIF_QRIB_XPU2_ACR_ADDR A:0x61938380
y.create.l HWIO_TCSR_MMSS_VENUS0_VBIF_QRIB_XPU2_VMIDEN_INIT_ADDR A:0x61938384
y.create.l HWIO_TCSR_MMSS_VENUS0_WRAPPER_QRIB_XPU2_ACR_ADDR A:0x61938390
y.create.l HWIO_TCSR_MMSS_VENUS0_WRAPPER_QRIB_XPU2_VMIDEN_INIT_ADDR A:0x61938394
y.create.l HWIO_TCSR_SS_XPU2_NON_SEC_INTR0_ADDR A:0x61939000
y.create.l HWIO_TCSR_SS_XPU2_NON_SEC_INTR0_ENABLE_ADDR A:0x61939040
y.create.l HWIO_TCSR_SS_VMIDMT_CLIENT_NON_SEC_INTR_ADDR A:0x61939010
y.create.l HWIO_TCSR_SS_VMIDMT_CLIENT_NON_SEC_INTR_ENABLE_ADDR A:0x61939050
y.create.l HWIO_TCSR_SS_VMIDMT_CFG_NON_SEC_INTR_ADDR A:0x61939090
y.create.l HWIO_TCSR_SS_VMIDMT_CFG_NON_SEC_INTR_ENABLE_ADDR A:0x619390d0
y.create.l HWIO_TCSR_MUTEX_REG_RESET_ADDR A:0x61939800
y.create.l HWIO_TCSR_SS_XPU2_SEC_INTR0_ADDR A:0x61939400
y.create.l HWIO_TCSR_SS_XPU2_SEC_INTR0_ENABLE_ADDR A:0x61939440
y.create.l HWIO_TCSR_SS_VMIDMT_CLIENT_SEC_INTR_ADDR A:0x61939410
y.create.l HWIO_TCSR_SS_VMIDMT_CLIENT_SEC_INTR_ENABLE_ADDR A:0x61939450
y.create.l HWIO_TCSR_SS_VMIDMT_CFG_SEC_INTR_ADDR A:0x61939490
y.create.l HWIO_TCSR_SS_VMIDMT_CFG_SEC_INTR_ENABLE_ADDR A:0x619394d0
y.create.l HWIO_TCSR_SS_XPU2_MSA_INTR0_ADDR A:0x6193a000
y.create.l HWIO_TCSR_SS_XPU2_MSA_INTR0_ENABLE_ADDR A:0x6193a010
y.create.l HWIO_TCSR_MSA_BIT_REG_ADDR A:0x6193a100
y.create.l HWIO_TCSR_TCSR_CLK_EN_ADDR A:0x6193b07c
y.create.l HWIO_TCSR_TIMEOUT_SLAVE_GLB_EN_ADDR A:0x6193c000
y.create.l HWIO_TCSR_XPU_NSEN_STATUS_ADDR A:0x6193c004
y.create.l HWIO_TCSR_XPU_VMIDEN_STATUS_ADDR A:0x6193c008
y.create.l HWIO_TCSR_XPU_MSAEN_STATUS_ADDR A:0x6193c00c
y.create.l HWIO_TCSR_MDP3_TIMEOUT_VAL_0_ADDR_ADDR A:0x6193c014
y.create.l HWIO_TCSR_MDP3_TIMEOUT_VAL_1_ADDR_ADDR A:0x6193c018
y.create.l HWIO_TCSR_MDP3_TIMEOUT_EN_ADDR A:0x6193c01c
y.create.l HWIO_TCSR_TZ_WONCE_0_ADDR A:0x6193d000
y.create.l HWIO_TCSR_TZ_WONCE_1_ADDR A:0x6193d004
y.create.l HWIO_TCSR_TZ_WONCE_2_ADDR A:0x6193d008
y.create.l HWIO_TCSR_TZ_WONCE_3_ADDR A:0x6193d00c
y.create.l HWIO_TCSR_TZ_WONCE_4_ADDR A:0x6193d010
y.create.l HWIO_TCSR_TZ_WONCE_5_ADDR A:0x6193d014
y.create.l HWIO_TCSR_TZ_WONCE_6_ADDR A:0x6193d018
y.create.l HWIO_TCSR_TZ_WONCE_7_ADDR A:0x6193d01c
y.create.l HWIO_TCSR_TZ_WONCE_8_ADDR A:0x6193d020
y.create.l HWIO_TCSR_TZ_WONCE_9_ADDR A:0x6193d024
y.create.l HWIO_TCSR_GCC_CLK_MUX_SEL_ADDR A:0x6193d0f0
y.create.l HWIO_TCSR_BOOT_MISC_DETECT_ADDR A:0x6193d100
y.create.l HWIO_TCSR_APSS_VMID_ADDR A:0x6193d110
y.create.l HWIO_TCSR_MMSS_RPM_IRQ_EN_ADDR A:0x6193e000
y.create.l HWIO_TCSR_MMSS_RPM_IRQ_CLEAR_ADDR A:0x6193e004
y.create.l HWIO_TCSR_MMSS_RPM_IRQ_STATUS_ADDR A:0x6193e008
y.create.l HWIO_TCSR_MMSS_OXILI_GC_SYS_AHB_STATUS_ADDR A:0x6193e010
y.create.l HWIO_TCSR_MMSS_OXILI_CMD_REG_ADDR A:0x6193e014
y.create.l HWIO_TCSR_MMSS_DSI_ULP_CLAMP_CTRL_ADDR A:0x6193e020
y.create.l HWIO_TCSR_MMSS_DSI_PHYRESET_CTRL_ADDR A:0x6193e024
y.create.l HWIO_TCSR_MMSS_IMEM_FSCGC_TIMERS_ADDR A:0x6193e030
y.create.l HWIO_TCSR_MMSS_IMEM_EX_FSCGC_CONTROL_ADDR A:0x6193e034
y.create.l HWIO_TCSR_MMSS_IMEM_RAM_CONFIG_ADDR A:0x6193e038
y.create.l HWIO_TCSR_TBU_BYPASS_ENABLE_ADDR A:0x6193f000
y.create.l HWIO_TCSR_RESET_DEBUG_SW_ENTRY_ADDR A:0x61940000
y.create.l HWIO_TCSR_QPDI_DISABLE_CFG_ADDR A:0x61941000
y.create.l HWIO_TCSR_COMPILER_VDDCX_ACC_0_ADDR A:0x61942080
y.create.l HWIO_TCSR_COMPILER_VDDCX_ACC_1_ADDR A:0x61942084
y.create.l HWIO_TCSR_CUSTOM_VDDCX_ACC_0_ADDR A:0x61942090
y.create.l HWIO_TCSR_CUSTOM_VDDCX_ACC_1_ADDR A:0x61942094
y.create.l HWIO_TCSR_MEM_ACC_SEL_VDDCX_ADDR A:0x61942100
y.create.l HWIO_TCSR_TCSR_S1LM_MODEM_TO_APPS_INT_ADDR A:0x61946000
y.create.l HWIO_TCSR_TCSR_S1LM_MODEM_TO_APPS_INT_DATA_ADDR A:0x61946004
y.create.l HWIO_TCSR_SPARE_APU_REG2_ADDR A:0x61946008
y.create.l HWIO_TCSR_SPARE_APU_REG3_ADDR A:0x6194600c
y.create.l HWIO_TCSR_SYS_POWER_CTRL_ADDR A:0x61947000
y.create.l HWIO_TCSR_USB_CORE_ID_ADDR A:0x61947004
y.create.l HWIO_TCSR_TEST_SPARE_CFG_REG_ADDR_ADDR A:0x61947508
y.create.l HWIO_TCSR_COMPILER_VDDMSS_ACC_0_ADDR A:0x61942104
y.create.l HWIO_TCSR_COMPILER_VDDMSS_ACC_1_ADDR A:0x61942108
y.create.l HWIO_TCSR_COMPILER_VDDAPC_ACC_0_ADDR A:0x6194210c
y.create.l HWIO_TCSR_COMPILER_VDDAPC_ACC_1_ADDR A:0x61942110
y.create.l HWIO_TCSR_CUSTOM_VDDAPC_ACC_0_ADDR A:0x61942120
y.create.l HWIO_TCSR_CUSTOM_VDDAPC_ACC_1_ADDR A:0x61942124
y.create.l HWIO_TCSR_CUSTOM_VDDAPC_ACC_2_ADDR A:0x61942128
y.create.l HWIO_TCSR_MEM_ACC_SEL_VDDMSS_ADDR A:0x6194212c
y.create.l HWIO_TCSR_MEM_ACC_SEL_VDDAPC_ADDR A:0x61942130
y.create.l HWIO_TCSR_CUSTOM_VDDCX_ACC_2_ADDR A:0x61942134
y.create.l HWIO_TCSR_LDO_SLEEP_CTRL_ADDR A:0x61948000
y.create.l HWIO_TCSR_LDO_UPDATE_STATE_CTRL_ADDR A:0x61948004
y.create.l HWIO_TCSR_LDO_OBIAS_CTRL_ADDR A:0x61948008
y.create.l HWIO_TCSR_LDO_VREF_CONFIG_ADDR A:0x6194800c
y.create.l HWIO_TCSR_LDO_IB_CONFIG_ADDR A:0x61948010
y.create.l HWIO_TCSR_LDO_BGC_CONFIG_ADDR A:0x61948014
y.create.l HWIO_TCSR_LDO_VREF_CTRL_ADDR A:0x61948018
y.create.l HWIO_TCSR_LDO_LD_EN_ADDR A:0x6194801c
y.create.l HWIO_TCSR_LDO_LD_CTRL_ADDR A:0x61948020
y.create.l HWIO_TCSR_LDO_OSC_RESETB_ADDR A:0x61948024
y.create.l HWIO_TCSR_LDO_OSC_CTRL_ADDR A:0x61948028
y.create.l HWIO_TCSR_LDO_DFT_EN_CTRL_ADDR A:0x6194802c
y.create.l HWIO_TCSR_LDO_DFT_CTRL_ADDR A:0x61948030
y.create.l HWIO_TCSR_SPDM_CNT_CLK_CTRL_ADDR A:0x6194a000
y.create.l HWIO_TCSR_SPDM_DLY_FIFO_EN_ADDR A:0x6194a004
y.create.l HWIO_TCSR_SPDM_STG1_MUX_SEL_ADDR A:0x6194a008
y.create.l HWIO_TCSR_SPDM_STG2_A_MUX_SEL_ADDR A:0x6194a00c
y.create.l HWIO_TCSR_SPDM_STG2_B_MUX_SEL_ADDR A:0x6194a010
y.create.l HWIO_TCSR_SPDM_STG3_A_MUX_SEL_ADDR A:0x6194a014
y.create.l HWIO_TCSR_SPDM_STG3_B_MUX_SEL_ADDR A:0x6194a018
y.create.l HWIO_TCSR_PHSS_USB2_PHY_SEL_ADDR A:0x6194b000
y.create.l HWIO_TCSR_PHSS_ATEST_USB2_PHY_SEL_ADDR A:0x6194b004
y.create.l HWIO_TCSR_PHSS_TEST_BUS_SEL_ADDR A:0x6194b008
y.create.l HWIO_TCSR_PHSS_UART_PRONTO_INT_SEL_0_ADDR A:0x6194b080
y.create.l HWIO_TCSR_PHSS_UART_PRONTO_INT_SEL_1_ADDR A:0x6194b090
y.create.l HWIO_TCSR_PHSS_UART_MSS_INT_SEL_0_ADDR A:0x6194b0c0
y.create.l HWIO_TCSR_PHSS_UART_MSS_INT_SEL_1_ADDR A:0x6194b0d0
y.create.l HWIO_TCSR_PHSS_QUP_PRONTO_INT_SEL_0_ADDR A:0x6194b100
y.create.l HWIO_TCSR_PHSS_QUP_PRONTO_INT_SEL_1_ADDR A:0x6194b110
y.create.l HWIO_TCSR_PHSS_QUP_MSS_INT_SEL_0_ADDR A:0x6194b140
y.create.l HWIO_TCSR_PHSS_QUP_MSS_INT_SEL_1_ADDR A:0x6194b150
y.create.l HWIO_TCSR_MEM_ARRY_STBY_ADDR A:0x6194c180
y.create.l HWIO_TCSR_SOC_HW_VERSION_ADDR A:0x6194d000
y.create.l HWIO_TCSR_TIMEOUT_INTR_STATUS_ADDR A:0x6194d020
y.create.l HWIO_TCSR_TIMEOUT_INTR_RPM_ENABLE_ADDR A:0x6194d030
y.create.l HWIO_TCSR_TIMEOUT_INTR_APSS_ENABLE_ADDR A:0x6194d040
y.create.l HWIO_TCSR_TIMEOUT_INTR_MSS_ENABLE_ADDR A:0x6194d060
y.create.l HWIO_TCSR_PRONTO_BUS_TIMEOUT_RESET_ADDR A:0x6194d070
y.create.l HWIO_TCSR_CRYPTO0_HALTREQ_ADDR A:0x6194e000
y.create.l HWIO_TCSR_CRYPTO0_HALTACK_ADDR A:0x6194e004
y.create.l HWIO_TCSR_CRYPTO0_MASTER_IDLE_ADDR A:0x6194e008
y.create.l HWIO_TCSR_MSSQ6_HALTREQ_ADDR A:0x6194f000
y.create.l HWIO_TCSR_MSSQ6_HALTACK_ADDR A:0x6194f004
y.create.l HWIO_TCSR_MSSQ6_MASTER_IDLE_ADDR A:0x6194f008
y.create.l HWIO_TCSR_MSSQ6_POWER_STATE_ADDR A:0x6194f010
y.create.l HWIO_TCSR_MSS_MODEM_HALTREQ_ADDR A:0x61950000
y.create.l HWIO_TCSR_MSS_MODEM_HALTACK_ADDR A:0x61950004
y.create.l HWIO_TCSR_MSS_MODEM_MASTER_IDLE_ADDR A:0x61950008
y.create.l HWIO_TCSR_MSS_NC_HALTREQ_ADDR A:0x61951000
y.create.l HWIO_TCSR_MSS_NC_HALTACK_ADDR A:0x61951004
y.create.l HWIO_TCSR_MSS_NC_MASTER_IDLE_ADDR A:0x61951008
y.create.l HWIO_TCSR_WCSS_HALTREQ_ADDR A:0x61952000
y.create.l HWIO_TCSR_WCSS_HALTACK_ADDR A:0x61952004
y.create.l HWIO_TCSR_WCSS_MASTER_IDLE_ADDR A:0x61952008
y.create.l HWIO_TCSR_SDC1_HALTREQ_ADDR A:0x61953000
y.create.l HWIO_TCSR_SDC1_HALTACK_ADDR A:0x61953004
y.create.l HWIO_TCSR_SDC1_MASTER_IDLE_ADDR A:0x61953008
y.create.l HWIO_TCSR_SDC2_HALTREQ_ADDR A:0x61954000
y.create.l HWIO_TCSR_SDC2_HALTACK_ADDR A:0x61954004
y.create.l HWIO_TCSR_SDC2_MASTER_IDLE_ADDR A:0x61954008
y.create.l HWIO_TCSR_ULT_AUDIO_CORE_ABORT_REQ_ADDR A:0x61955000
y.create.l HWIO_TCSR_ULT_AUDIO_CORE_ABORT_ACK_ADDR A:0x61955004
y.create.l HWIO_TCSR_TCSR_S1LM_APPS_TO_MODEM_INT_ADDR A:0x61956000
y.create.l HWIO_TCSR_TCSR_S1LM_APPS_TO_MODEM_INT_DATA_ADDR A:0x61956004
y.create.l HWIO_TCSR_SPARE_REG2_ADDR A:0x61956008
y.create.l HWIO_TCSR_SPARE_REG3_ADDR A:0x6195600c
y.create.l HWIO_TCSR_PNOC_SNOC_MEMTYPE_ADDR A:0x61957000
y.create.l HWIO_CRYPTO0_CRYPTO_VERSION_ADDR A:0x6073a000
y.create.l HWIO_CRYPTO0_CRYPTO_DATA_IN0_ADDR A:0x6073a010
y.create.l HWIO_CRYPTO0_CRYPTO_DATA_IN1_ADDR A:0x6073a014
y.create.l HWIO_CRYPTO0_CRYPTO_DATA_IN2_ADDR A:0x6073a018
y.create.l HWIO_CRYPTO0_CRYPTO_DATA_IN3_ADDR A:0x6073a01c
y.create.l HWIO_CRYPTO0_CRYPTO_DATA_OUT0_ADDR A:0x6073a020
y.create.l HWIO_CRYPTO0_CRYPTO_DATA_OUT1_ADDR A:0x6073a024
y.create.l HWIO_CRYPTO0_CRYPTO_DATA_OUT2_ADDR A:0x6073a028
y.create.l HWIO_CRYPTO0_CRYPTO_DATA_OUT3_ADDR A:0x6073a02c
y.create.l HWIO_CRYPTO0_CRYPTO_STATUS_ADDR A:0x6073a100
y.create.l HWIO_CRYPTO0_CRYPTO_STATUS2_ADDR A:0x6073a104
y.create.l HWIO_CRYPTO0_CRYPTO_ENGINES_AVAIL_ADDR A:0x6073a108
y.create.l HWIO_CRYPTO0_CRYPTO_FIFO_SIZES_ADDR A:0x6073a10c
y.create.l HWIO_CRYPTO0_CRYPTO_SEG_SIZE_ADDR A:0x6073a110
y.create.l HWIO_CRYPTO0_CRYPTO_GOPROC_ADDR A:0x6073a120
y.create.l HWIO_CRYPTO0_CRYPTO_GOPROC_QC_KEY_ADDR A:0x6073b000
y.create.l HWIO_CRYPTO0_CRYPTO_GOPROC_OEM_KEY_ADDR A:0x6073c000
y.create.l HWIO_CRYPTO0_CRYPTO_ENCR_SEG_CFG_ADDR A:0x6073a200
y.create.l HWIO_CRYPTO0_CRYPTO_ENCR_SEG_SIZE_ADDR A:0x6073a204
y.create.l HWIO_CRYPTO0_CRYPTO_ENCR_SEG_START_ADDR A:0x6073a208
y.create.l HWIO_CRYPTO0_CRYPTO_ENCR_KEY0_ADDR A:0x6073d000
y.create.l HWIO_CRYPTO0_CRYPTO_ENCR_KEY1_ADDR A:0x6073d004
y.create.l HWIO_CRYPTO0_CRYPTO_ENCR_KEY2_ADDR A:0x6073d008
y.create.l HWIO_CRYPTO0_CRYPTO_ENCR_KEY3_ADDR A:0x6073d00c
y.create.l HWIO_CRYPTO0_CRYPTO_ENCR_KEY4_ADDR A:0x6073d010
y.create.l HWIO_CRYPTO0_CRYPTO_ENCR_KEY5_ADDR A:0x6073d014
y.create.l HWIO_CRYPTO0_CRYPTO_ENCR_KEY6_ADDR A:0x6073d018
y.create.l HWIO_CRYPTO0_CRYPTO_ENCR_KEY7_ADDR A:0x6073d01c
y.create.l HWIO_CRYPTO0_CRYPTO_ENCR_PIPE0_KEY0_ADDR A:0x6073e000
y.create.l HWIO_CRYPTO0_CRYPTO_ENCR_PIPE0_KEY1_ADDR A:0x6073e004
y.create.l HWIO_CRYPTO0_CRYPTO_ENCR_PIPE0_KEY2_ADDR A:0x6073e008
y.create.l HWIO_CRYPTO0_CRYPTO_ENCR_PIPE0_KEY3_ADDR A:0x6073e00c
y.create.l HWIO_CRYPTO0_CRYPTO_ENCR_PIPE1_KEY0_ADDR A:0x6073e020
y.create.l HWIO_CRYPTO0_CRYPTO_ENCR_PIPE1_KEY1_ADDR A:0x6073e024
y.create.l HWIO_CRYPTO0_CRYPTO_ENCR_PIPE1_KEY2_ADDR A:0x6073e028
y.create.l HWIO_CRYPTO0_CRYPTO_ENCR_PIPE1_KEY3_ADDR A:0x6073e02c
y.create.l HWIO_CRYPTO0_CRYPTO_ENCR_PIPE2_KEY0_ADDR A:0x6073e040
y.create.l HWIO_CRYPTO0_CRYPTO_ENCR_PIPE2_KEY1_ADDR A:0x6073e044
y.create.l HWIO_CRYPTO0_CRYPTO_ENCR_PIPE2_KEY2_ADDR A:0x6073e048
y.create.l HWIO_CRYPTO0_CRYPTO_ENCR_PIPE2_KEY3_ADDR A:0x6073e04c
y.create.l HWIO_CRYPTO0_CRYPTO_ENCR_PIPE3_KEY0_ADDR A:0x6073e060
y.create.l HWIO_CRYPTO0_CRYPTO_ENCR_PIPE3_KEY1_ADDR A:0x6073e064
y.create.l HWIO_CRYPTO0_CRYPTO_ENCR_PIPE3_KEY2_ADDR A:0x6073e068
y.create.l HWIO_CRYPTO0_CRYPTO_ENCR_PIPE3_KEY3_ADDR A:0x6073e06c
y.create.l HWIO_CRYPTO0_CRYPTO_ENCR_XTS_KEY0_ADDR A:0x6073d020
y.create.l HWIO_CRYPTO0_CRYPTO_ENCR_XTS_KEY1_ADDR A:0x6073d024
y.create.l HWIO_CRYPTO0_CRYPTO_ENCR_XTS_KEY2_ADDR A:0x6073d028
y.create.l HWIO_CRYPTO0_CRYPTO_ENCR_XTS_KEY3_ADDR A:0x6073d02c
y.create.l HWIO_CRYPTO0_CRYPTO_ENCR_XTS_KEY4_ADDR A:0x6073d030
y.create.l HWIO_CRYPTO0_CRYPTO_ENCR_XTS_KEY5_ADDR A:0x6073d034
y.create.l HWIO_CRYPTO0_CRYPTO_ENCR_XTS_KEY6_ADDR A:0x6073d038
y.create.l HWIO_CRYPTO0_CRYPTO_ENCR_XTS_KEY7_ADDR A:0x6073d03c
y.create.l HWIO_CRYPTO0_CRYPTO_ENCR_PIPE0_XTS_KEY0_ADDR A:0x6073e200
y.create.l HWIO_CRYPTO0_CRYPTO_ENCR_PIPE0_XTS_KEY1_ADDR A:0x6073e204
y.create.l HWIO_CRYPTO0_CRYPTO_ENCR_PIPE0_XTS_KEY2_ADDR A:0x6073e208
y.create.l HWIO_CRYPTO0_CRYPTO_ENCR_PIPE0_XTS_KEY3_ADDR A:0x6073e20c
y.create.l HWIO_CRYPTO0_CRYPTO_ENCR_PIPE1_XTS_KEY0_ADDR A:0x6073e220
y.create.l HWIO_CRYPTO0_CRYPTO_ENCR_PIPE1_XTS_KEY1_ADDR A:0x6073e224
y.create.l HWIO_CRYPTO0_CRYPTO_ENCR_PIPE1_XTS_KEY2_ADDR A:0x6073e228
y.create.l HWIO_CRYPTO0_CRYPTO_ENCR_PIPE1_XTS_KEY3_ADDR A:0x6073e22c
y.create.l HWIO_CRYPTO0_CRYPTO_ENCR_PIPE2_XTS_KEY0_ADDR A:0x6073e240
y.create.l HWIO_CRYPTO0_CRYPTO_ENCR_PIPE2_XTS_KEY1_ADDR A:0x6073e244
y.create.l HWIO_CRYPTO0_CRYPTO_ENCR_PIPE2_XTS_KEY2_ADDR A:0x6073e248
y.create.l HWIO_CRYPTO0_CRYPTO_ENCR_PIPE2_XTS_KEY3_ADDR A:0x6073e24c
y.create.l HWIO_CRYPTO0_CRYPTO_ENCR_PIPE3_XTS_KEY0_ADDR A:0x6073e260
y.create.l HWIO_CRYPTO0_CRYPTO_ENCR_PIPE3_XTS_KEY1_ADDR A:0x6073e264
y.create.l HWIO_CRYPTO0_CRYPTO_ENCR_PIPE3_XTS_KEY2_ADDR A:0x6073e268
y.create.l HWIO_CRYPTO0_CRYPTO_ENCR_PIPE3_XTS_KEY3_ADDR A:0x6073e26c
y.create.l HWIO_CRYPTO0_CRYPTO_ENCR_PIPE0_ODD_KEY0_ADDR A:0x6073e400
y.create.l HWIO_CRYPTO0_CRYPTO_ENCR_PIPE0_ODD_KEY1_ADDR A:0x6073e404
y.create.l HWIO_CRYPTO0_CRYPTO_ENCR_PIPE0_ODD_KEY2_ADDR A:0x6073e408
y.create.l HWIO_CRYPTO0_CRYPTO_ENCR_PIPE0_ODD_KEY3_ADDR A:0x6073e40c
y.create.l HWIO_CRYPTO0_CRYPTO_ENCR_PIPE1_ODD_KEY0_ADDR A:0x6073e420
y.create.l HWIO_CRYPTO0_CRYPTO_ENCR_PIPE1_ODD_KEY1_ADDR A:0x6073e424
y.create.l HWIO_CRYPTO0_CRYPTO_ENCR_PIPE1_ODD_KEY2_ADDR A:0x6073e428
y.create.l HWIO_CRYPTO0_CRYPTO_ENCR_PIPE1_ODD_KEY3_ADDR A:0x6073e42c
y.create.l HWIO_CRYPTO0_CRYPTO_ENCR_PIPE2_ODD_KEY0_ADDR A:0x6073e440
y.create.l HWIO_CRYPTO0_CRYPTO_ENCR_PIPE2_ODD_KEY1_ADDR A:0x6073e444
y.create.l HWIO_CRYPTO0_CRYPTO_ENCR_PIPE2_ODD_KEY2_ADDR A:0x6073e448
y.create.l HWIO_CRYPTO0_CRYPTO_ENCR_PIPE2_ODD_KEY3_ADDR A:0x6073e44c
y.create.l HWIO_CRYPTO0_CRYPTO_ENCR_PIPE3_ODD_KEY0_ADDR A:0x6073e460
y.create.l HWIO_CRYPTO0_CRYPTO_ENCR_PIPE3_ODD_KEY1_ADDR A:0x6073e464
y.create.l HWIO_CRYPTO0_CRYPTO_ENCR_PIPE3_ODD_KEY2_ADDR A:0x6073e468
y.create.l HWIO_CRYPTO0_CRYPTO_ENCR_PIPE3_ODD_KEY3_ADDR A:0x6073e46c
y.create.l HWIO_CRYPTO0_CRYPTO_ENCR_PIPE0_XTS_ODD_KEY0_ADDR A:0x6073e600
y.create.l HWIO_CRYPTO0_CRYPTO_ENCR_PIPE0_XTS_ODD_KEY1_ADDR A:0x6073e604
y.create.l HWIO_CRYPTO0_CRYPTO_ENCR_PIPE0_XTS_ODD_KEY2_ADDR A:0x6073e608
y.create.l HWIO_CRYPTO0_CRYPTO_ENCR_PIPE0_XTS_ODD_KEY3_ADDR A:0x6073e60c
y.create.l HWIO_CRYPTO0_CRYPTO_ENCR_PIPE1_XTS_ODD_KEY0_ADDR A:0x6073e620
y.create.l HWIO_CRYPTO0_CRYPTO_ENCR_PIPE1_XTS_ODD_KEY1_ADDR A:0x6073e624
y.create.l HWIO_CRYPTO0_CRYPTO_ENCR_PIPE1_XTS_ODD_KEY2_ADDR A:0x6073e628
y.create.l HWIO_CRYPTO0_CRYPTO_ENCR_PIPE1_XTS_ODD_KEY3_ADDR A:0x6073e62c
y.create.l HWIO_CRYPTO0_CRYPTO_ENCR_PIPE2_XTS_ODD_KEY0_ADDR A:0x6073e640
y.create.l HWIO_CRYPTO0_CRYPTO_ENCR_PIPE2_XTS_ODD_KEY1_ADDR A:0x6073e644
y.create.l HWIO_CRYPTO0_CRYPTO_ENCR_PIPE2_XTS_ODD_KEY2_ADDR A:0x6073e648
y.create.l HWIO_CRYPTO0_CRYPTO_ENCR_PIPE2_XTS_ODD_KEY3_ADDR A:0x6073e64c
y.create.l HWIO_CRYPTO0_CRYPTO_ENCR_PIPE3_XTS_ODD_KEY0_ADDR A:0x6073e660
y.create.l HWIO_CRYPTO0_CRYPTO_ENCR_PIPE3_XTS_ODD_KEY1_ADDR A:0x6073e664
y.create.l HWIO_CRYPTO0_CRYPTO_ENCR_PIPE3_XTS_ODD_KEY2_ADDR A:0x6073e668
y.create.l HWIO_CRYPTO0_CRYPTO_ENCR_PIPE3_XTS_ODD_KEY3_ADDR A:0x6073e66c
y.create.l HWIO_CRYPTO0_CRYPTO_ENCR_CNTR0_IV0_ADDR A:0x6073a20c
y.create.l HWIO_CRYPTO0_CRYPTO_ENCR_CNTR1_IV1_ADDR A:0x6073a210
y.create.l HWIO_CRYPTO0_CRYPTO_ENCR_CNTR2_IV2_ADDR A:0x6073a214
y.create.l HWIO_CRYPTO0_CRYPTO_ENCR_CNTR3_IV3_ADDR A:0x6073a218
y.create.l HWIO_CRYPTO0_CRYPTO_ENCR_CNTR_MASK_ADDR A:0x6073a21c
y.create.l HWIO_CRYPTO0_CRYPTO_ENCR_CNTR_MASK2_ADDR A:0x6073a234
y.create.l HWIO_CRYPTO0_CRYPTO_ENCR_CNTR_MASK1_ADDR A:0x6073a238
y.create.l HWIO_CRYPTO0_CRYPTO_ENCR_CNTR_MASK0_ADDR A:0x6073a23c
y.create.l HWIO_CRYPTO0_CRYPTO_ENCR_CCM_INIT_CNTR0_ADDR A:0x6073a220
y.create.l HWIO_CRYPTO0_CRYPTO_ENCR_CCM_INIT_CNTR1_ADDR A:0x6073a224
y.create.l HWIO_CRYPTO0_CRYPTO_ENCR_CCM_INIT_CNTR2_ADDR A:0x6073a228
y.create.l HWIO_CRYPTO0_CRYPTO_ENCR_CCM_INIT_CNTR3_ADDR A:0x6073a22c
y.create.l HWIO_CRYPTO0_CRYPTO_ENCR_XTS_DU_SIZE_ADDR A:0x6073a230
y.create.l HWIO_CRYPTO0_CRYPTO_AUTH_SEG_CFG_ADDR A:0x6073a300
y.create.l HWIO_CRYPTO0_CRYPTO_AUTH_SEG_SIZE_ADDR A:0x6073a304
y.create.l HWIO_CRYPTO0_CRYPTO_AUTH_SEG_START_ADDR A:0x6073a308
y.create.l HWIO_CRYPTO0_CRYPTO_AUTH_KEY0_ADDR A:0x6073d040
y.create.l HWIO_CRYPTO0_CRYPTO_AUTH_KEY1_ADDR A:0x6073d044
y.create.l HWIO_CRYPTO0_CRYPTO_AUTH_KEY2_ADDR A:0x6073d048
y.create.l HWIO_CRYPTO0_CRYPTO_AUTH_KEY3_ADDR A:0x6073d04c
y.create.l HWIO_CRYPTO0_CRYPTO_AUTH_KEY4_ADDR A:0x6073d050
y.create.l HWIO_CRYPTO0_CRYPTO_AUTH_KEY5_ADDR A:0x6073d054
y.create.l HWIO_CRYPTO0_CRYPTO_AUTH_KEY6_ADDR A:0x6073d058
y.create.l HWIO_CRYPTO0_CRYPTO_AUTH_KEY7_ADDR A:0x6073d05c
y.create.l HWIO_CRYPTO0_CRYPTO_AUTH_KEY8_ADDR A:0x6073d060
y.create.l HWIO_CRYPTO0_CRYPTO_AUTH_KEY9_ADDR A:0x6073d064
y.create.l HWIO_CRYPTO0_CRYPTO_AUTH_PIPE0_KEY0_ADDR A:0x6073e800
y.create.l HWIO_CRYPTO0_CRYPTO_AUTH_PIPE0_KEY1_ADDR A:0x6073e804
y.create.l HWIO_CRYPTO0_CRYPTO_AUTH_PIPE0_KEY2_ADDR A:0x6073e808
y.create.l HWIO_CRYPTO0_CRYPTO_AUTH_PIPE0_KEY3_ADDR A:0x6073e80c
y.create.l HWIO_CRYPTO0_CRYPTO_AUTH_PIPE1_KEY0_ADDR A:0x6073e880
y.create.l HWIO_CRYPTO0_CRYPTO_AUTH_PIPE1_KEY1_ADDR A:0x6073e884
y.create.l HWIO_CRYPTO0_CRYPTO_AUTH_PIPE1_KEY2_ADDR A:0x6073e888
y.create.l HWIO_CRYPTO0_CRYPTO_AUTH_PIPE1_KEY3_ADDR A:0x6073e88c
y.create.l HWIO_CRYPTO0_CRYPTO_AUTH_PIPE2_KEY0_ADDR A:0x6073e900
y.create.l HWIO_CRYPTO0_CRYPTO_AUTH_PIPE2_KEY1_ADDR A:0x6073e904
y.create.l HWIO_CRYPTO0_CRYPTO_AUTH_PIPE2_KEY2_ADDR A:0x6073e908
y.create.l HWIO_CRYPTO0_CRYPTO_AUTH_PIPE2_KEY3_ADDR A:0x6073e90c
y.create.l HWIO_CRYPTO0_CRYPTO_AUTH_PIPE3_KEY0_ADDR A:0x6073e980
y.create.l HWIO_CRYPTO0_CRYPTO_AUTH_PIPE3_KEY1_ADDR A:0x6073e984
y.create.l HWIO_CRYPTO0_CRYPTO_AUTH_PIPE3_KEY2_ADDR A:0x6073e988
y.create.l HWIO_CRYPTO0_CRYPTO_AUTH_PIPE3_KEY3_ADDR A:0x6073e98c
y.create.l HWIO_CRYPTO0_CRYPTO_AUTH_IV0_ADDR A:0x6073a310
y.create.l HWIO_CRYPTO0_CRYPTO_AUTH_IV1_ADDR A:0x6073a314
y.create.l HWIO_CRYPTO0_CRYPTO_AUTH_IV2_ADDR A:0x6073a318
y.create.l HWIO_CRYPTO0_CRYPTO_AUTH_IV3_ADDR A:0x6073a31c
y.create.l HWIO_CRYPTO0_CRYPTO_AUTH_IV4_ADDR A:0x6073a320
y.create.l HWIO_CRYPTO0_CRYPTO_AUTH_IV5_ADDR A:0x6073a324
y.create.l HWIO_CRYPTO0_CRYPTO_AUTH_IV6_ADDR A:0x6073a328
y.create.l HWIO_CRYPTO0_CRYPTO_AUTH_IV7_ADDR A:0x6073a32c
y.create.l HWIO_CRYPTO0_CRYPTO_AUTH_INFO_NONCE0_ADDR A:0x6073a350
y.create.l HWIO_CRYPTO0_CRYPTO_AUTH_INFO_NONCE1_ADDR A:0x6073a354
y.create.l HWIO_CRYPTO0_CRYPTO_AUTH_INFO_NONCE2_ADDR A:0x6073a358
y.create.l HWIO_CRYPTO0_CRYPTO_AUTH_INFO_NONCE3_ADDR A:0x6073a35c
y.create.l HWIO_CRYPTO0_CRYPTO_AUTH_BYTECNT0_ADDR A:0x6073a390
y.create.l HWIO_CRYPTO0_CRYPTO_AUTH_BYTECNT1_ADDR A:0x6073a394
y.create.l HWIO_CRYPTO0_CRYPTO_AUTH_EXP_MAC0_ADDR A:0x6073a3a0
y.create.l HWIO_CRYPTO0_CRYPTO_AUTH_EXP_MAC1_ADDR A:0x6073a3a4
y.create.l HWIO_CRYPTO0_CRYPTO_AUTH_EXP_MAC2_ADDR A:0x6073a3a8
y.create.l HWIO_CRYPTO0_CRYPTO_AUTH_EXP_MAC3_ADDR A:0x6073a3ac
y.create.l HWIO_CRYPTO0_CRYPTO_AUTH_EXP_MAC4_ADDR A:0x6073a3b0
y.create.l HWIO_CRYPTO0_CRYPTO_AUTH_EXP_MAC5_ADDR A:0x6073a3b4
y.create.l HWIO_CRYPTO0_CRYPTO_AUTH_EXP_MAC6_ADDR A:0x6073a3b8
y.create.l HWIO_CRYPTO0_CRYPTO_AUTH_EXP_MAC7_ADDR A:0x6073a3bc
y.create.l HWIO_CRYPTO0_CRYPTO_CONFIG_ADDR A:0x6073a400
y.create.l HWIO_CRYPTO0_CRYPTO_DEBUG_ENABLE_ADDR A:0x6073f000
y.create.l HWIO_CRYPTO0_CRYPTO_DEBUG_ADDR A:0x6073f004
y.create.l HWIO_CRYPTO0_CRYPTO_PWR_CTRL_ADDR A:0x6073f008
y.create.l HWIO_CRYPTO0_CRYPTO_BAM_CTRL_ADDR A:0x60704000
y.create.l HWIO_CRYPTO0_CRYPTO_BAM_TIMER_ADDR A:0x60704040
y.create.l HWIO_CRYPTO0_CRYPTO_BAM_TIMER_CTRL_ADDR A:0x60704044
y.create.l HWIO_CRYPTO0_CRYPTO_BAM_DESC_CNT_TRSHLD_ADDR A:0x60704008
y.create.l HWIO_CRYPTO0_CRYPTO_BAM_IRQ_STTS_ADDR A:0x60704014
y.create.l HWIO_CRYPTO0_CRYPTO_BAM_IRQ_CLR_ADDR A:0x60704018
y.create.l HWIO_CRYPTO0_CRYPTO_BAM_IRQ_EN_ADDR A:0x6070401c
y.create.l HWIO_CRYPTO0_CRYPTO_BAM_CNFG_BITS_ADDR A:0x6070407c
y.create.l HWIO_CRYPTO0_CRYPTO_BAM_REVISION_ADDR A:0x60705000
y.create.l HWIO_CRYPTO0_CRYPTO_BAM_SW_VERSION_ADDR A:0x60705004
y.create.l HWIO_CRYPTO0_CRYPTO_BAM_NUM_PIPES_ADDR A:0x60705008
y.create.l HWIO_CRYPTO0_CRYPTO_BAM_TEST_BUS_SEL_ADDR A:0x60705010
y.create.l HWIO_CRYPTO0_CRYPTO_BAM_TEST_BUS_REG_ADDR A:0x60705014
y.create.l HWIO_CRYPTO0_CRYPTO_BAM_AHB_MASTER_ERR_CTRLS_ADDR A:0x60705024
y.create.l HWIO_CRYPTO0_CRYPTO_BAM_AHB_MASTER_ERR_ADDR_ADDR A:0x60705028
y.create.l HWIO_CRYPTO0_CRYPTO_BAM_AHB_MASTER_ERR_DATA_ADDR A:0x6070502c
y.create.l HWIO_CRYPTO0_CRYPTO_BAM_AHB_MASTER_ERR_ADDR_LSB_ADDR A:0x60705100
y.create.l HWIO_CRYPTO0_CRYPTO_BAM_AHB_MASTER_ERR_ADDR_MSB_ADDR A:0x60705104
y.create.l HWIO_CRYPTO0_CRYPTO_BAM_TRUST_REG_ADDR A:0x60706000
y.create.l HWIO_CRYPTO0_CRYPTO_BAM_P_TRUST_REG0_ADDR A:0x60706020
y.create.l HWIO_CRYPTO0_CRYPTO_BAM_P_TRUST_REG1_ADDR A:0x60706024
y.create.l HWIO_CRYPTO0_CRYPTO_BAM_P_TRUST_REG2_ADDR A:0x60706028
y.create.l HWIO_CRYPTO0_CRYPTO_BAM_P_TRUST_REG3_ADDR A:0x6070602c
y.create.l HWIO_CRYPTO0_CRYPTO_BAM_P_TRUST_REG4_ADDR A:0x60706030
y.create.l HWIO_CRYPTO0_CRYPTO_BAM_P_TRUST_REG5_ADDR A:0x60706034
y.create.l HWIO_CRYPTO0_CRYPTO_BAM_P_TRUST_REG6_ADDR A:0x60706038
y.create.l HWIO_CRYPTO0_CRYPTO_BAM_P_TRUST_REG7_ADDR A:0x6070603c
y.create.l HWIO_CRYPTO0_CRYPTO_BAM_IRQ_SRCS_EE0_ADDR A:0x60707000
y.create.l HWIO_CRYPTO0_CRYPTO_BAM_IRQ_SRCS_EE1_ADDR A:0x60708000
y.create.l HWIO_CRYPTO0_CRYPTO_BAM_IRQ_SRCS_EE2_ADDR A:0x60709000
y.create.l HWIO_CRYPTO0_CRYPTO_BAM_IRQ_SRCS_EE3_ADDR A:0x6070a000
y.create.l HWIO_CRYPTO0_CRYPTO_BAM_IRQ_SRCS_EE4_ADDR A:0x6070b000
y.create.l HWIO_CRYPTO0_CRYPTO_BAM_IRQ_SRCS_EE5_ADDR A:0x6070c000
y.create.l HWIO_CRYPTO0_CRYPTO_BAM_IRQ_SRCS_EE6_ADDR A:0x6070d000
y.create.l HWIO_CRYPTO0_CRYPTO_BAM_IRQ_SRCS_EE7_ADDR A:0x6070e000
y.create.l HWIO_CRYPTO0_CRYPTO_BAM_IRQ_SRCS_MSK_EE0_ADDR A:0x60707004
y.create.l HWIO_CRYPTO0_CRYPTO_BAM_IRQ_SRCS_MSK_EE1_ADDR A:0x60708004
y.create.l HWIO_CRYPTO0_CRYPTO_BAM_IRQ_SRCS_MSK_EE2_ADDR A:0x60709004
y.create.l HWIO_CRYPTO0_CRYPTO_BAM_IRQ_SRCS_MSK_EE3_ADDR A:0x6070a004
y.create.l HWIO_CRYPTO0_CRYPTO_BAM_IRQ_SRCS_MSK_EE4_ADDR A:0x6070b004
y.create.l HWIO_CRYPTO0_CRYPTO_BAM_IRQ_SRCS_MSK_EE5_ADDR A:0x6070c004
y.create.l HWIO_CRYPTO0_CRYPTO_BAM_IRQ_SRCS_MSK_EE6_ADDR A:0x6070d004
y.create.l HWIO_CRYPTO0_CRYPTO_BAM_IRQ_SRCS_MSK_EE7_ADDR A:0x6070e004
y.create.l HWIO_CRYPTO0_CRYPTO_BAM_IRQ_SRCS_UNMASKED_EE0_ADDR A:0x60707008
y.create.l HWIO_CRYPTO0_CRYPTO_BAM_IRQ_SRCS_UNMASKED_EE1_ADDR A:0x60708008
y.create.l HWIO_CRYPTO0_CRYPTO_BAM_IRQ_SRCS_UNMASKED_EE2_ADDR A:0x60709008
y.create.l HWIO_CRYPTO0_CRYPTO_BAM_IRQ_SRCS_UNMASKED_EE3_ADDR A:0x6070a008
y.create.l HWIO_CRYPTO0_CRYPTO_BAM_IRQ_SRCS_UNMASKED_EE4_ADDR A:0x6070b008
y.create.l HWIO_CRYPTO0_CRYPTO_BAM_IRQ_SRCS_UNMASKED_EE5_ADDR A:0x6070c008
y.create.l HWIO_CRYPTO0_CRYPTO_BAM_IRQ_SRCS_UNMASKED_EE6_ADDR A:0x6070d008
y.create.l HWIO_CRYPTO0_CRYPTO_BAM_IRQ_SRCS_UNMASKED_EE7_ADDR A:0x6070e008
y.create.l HWIO_CRYPTO0_CRYPTO_BAM_PIPE_ATTR_EE0_ADDR A:0x6070700c
y.create.l HWIO_CRYPTO0_CRYPTO_BAM_PIPE_ATTR_EE1_ADDR A:0x6070800c
y.create.l HWIO_CRYPTO0_CRYPTO_BAM_PIPE_ATTR_EE2_ADDR A:0x6070900c
y.create.l HWIO_CRYPTO0_CRYPTO_BAM_PIPE_ATTR_EE3_ADDR A:0x6070a00c
y.create.l HWIO_CRYPTO0_CRYPTO_BAM_PIPE_ATTR_EE4_ADDR A:0x6070b00c
y.create.l HWIO_CRYPTO0_CRYPTO_BAM_PIPE_ATTR_EE5_ADDR A:0x6070c00c
y.create.l HWIO_CRYPTO0_CRYPTO_BAM_PIPE_ATTR_EE6_ADDR A:0x6070d00c
y.create.l HWIO_CRYPTO0_CRYPTO_BAM_PIPE_ATTR_EE7_ADDR A:0x6070e00c
y.create.l HWIO_CRYPTO0_CRYPTO_BAM_IRQ_SRCS_ADDR A:0x60707010
y.create.l HWIO_CRYPTO0_CRYPTO_BAM_IRQ_SRCS_MSK_ADDR A:0x60707014
y.create.l HWIO_CRYPTO0_CRYPTO_BAM_IRQ_SRCS_UNMASKED_ADDR A:0x60707018
y.create.l HWIO_CRYPTO0_CRYPTO_BAM_P_CTRL0_ADDR A:0x60717000
y.create.l HWIO_CRYPTO0_CRYPTO_BAM_P_CTRL1_ADDR A:0x60718000
y.create.l HWIO_CRYPTO0_CRYPTO_BAM_P_CTRL2_ADDR A:0x60719000
y.create.l HWIO_CRYPTO0_CRYPTO_BAM_P_CTRL3_ADDR A:0x6071a000
y.create.l HWIO_CRYPTO0_CRYPTO_BAM_P_CTRL4_ADDR A:0x6071b000
y.create.l HWIO_CRYPTO0_CRYPTO_BAM_P_CTRL5_ADDR A:0x6071c000
y.create.l HWIO_CRYPTO0_CRYPTO_BAM_P_CTRL6_ADDR A:0x6071d000
y.create.l HWIO_CRYPTO0_CRYPTO_BAM_P_CTRL7_ADDR A:0x6071e000
y.create.l HWIO_CRYPTO0_CRYPTO_BAM_P_RST0_ADDR A:0x60717004
y.create.l HWIO_CRYPTO0_CRYPTO_BAM_P_RST1_ADDR A:0x60718004
y.create.l HWIO_CRYPTO0_CRYPTO_BAM_P_RST2_ADDR A:0x60719004
y.create.l HWIO_CRYPTO0_CRYPTO_BAM_P_RST3_ADDR A:0x6071a004
y.create.l HWIO_CRYPTO0_CRYPTO_BAM_P_RST4_ADDR A:0x6071b004
y.create.l HWIO_CRYPTO0_CRYPTO_BAM_P_RST5_ADDR A:0x6071c004
y.create.l HWIO_CRYPTO0_CRYPTO_BAM_P_RST6_ADDR A:0x6071d004
y.create.l HWIO_CRYPTO0_CRYPTO_BAM_P_RST7_ADDR A:0x6071e004
y.create.l HWIO_CRYPTO0_CRYPTO_BAM_P_HALT0_ADDR A:0x60717008
y.create.l HWIO_CRYPTO0_CRYPTO_BAM_P_HALT1_ADDR A:0x60718008
y.create.l HWIO_CRYPTO0_CRYPTO_BAM_P_HALT2_ADDR A:0x60719008
y.create.l HWIO_CRYPTO0_CRYPTO_BAM_P_HALT3_ADDR A:0x6071a008
y.create.l HWIO_CRYPTO0_CRYPTO_BAM_P_HALT4_ADDR A:0x6071b008
y.create.l HWIO_CRYPTO0_CRYPTO_BAM_P_HALT5_ADDR A:0x6071c008
y.create.l HWIO_CRYPTO0_CRYPTO_BAM_P_HALT6_ADDR A:0x6071d008
y.create.l HWIO_CRYPTO0_CRYPTO_BAM_P_HALT7_ADDR A:0x6071e008
y.create.l HWIO_CRYPTO0_CRYPTO_BAM_P_IRQ_STTS0_ADDR A:0x60717010
y.create.l HWIO_CRYPTO0_CRYPTO_BAM_P_IRQ_STTS1_ADDR A:0x60718010
y.create.l HWIO_CRYPTO0_CRYPTO_BAM_P_IRQ_STTS2_ADDR A:0x60719010
y.create.l HWIO_CRYPTO0_CRYPTO_BAM_P_IRQ_STTS3_ADDR A:0x6071a010
y.create.l HWIO_CRYPTO0_CRYPTO_BAM_P_IRQ_STTS4_ADDR A:0x6071b010
y.create.l HWIO_CRYPTO0_CRYPTO_BAM_P_IRQ_STTS5_ADDR A:0x6071c010
y.create.l HWIO_CRYPTO0_CRYPTO_BAM_P_IRQ_STTS6_ADDR A:0x6071d010
y.create.l HWIO_CRYPTO0_CRYPTO_BAM_P_IRQ_STTS7_ADDR A:0x6071e010
y.create.l HWIO_CRYPTO0_CRYPTO_BAM_P_IRQ_CLR0_ADDR A:0x60717014
y.create.l HWIO_CRYPTO0_CRYPTO_BAM_P_IRQ_CLR1_ADDR A:0x60718014
y.create.l HWIO_CRYPTO0_CRYPTO_BAM_P_IRQ_CLR2_ADDR A:0x60719014
y.create.l HWIO_CRYPTO0_CRYPTO_BAM_P_IRQ_CLR3_ADDR A:0x6071a014
y.create.l HWIO_CRYPTO0_CRYPTO_BAM_P_IRQ_CLR4_ADDR A:0x6071b014
y.create.l HWIO_CRYPTO0_CRYPTO_BAM_P_IRQ_CLR5_ADDR A:0x6071c014
y.create.l HWIO_CRYPTO0_CRYPTO_BAM_P_IRQ_CLR6_ADDR A:0x6071d014
y.create.l HWIO_CRYPTO0_CRYPTO_BAM_P_IRQ_CLR7_ADDR A:0x6071e014
y.create.l HWIO_CRYPTO0_CRYPTO_BAM_P_IRQ_EN0_ADDR A:0x60717018
y.create.l HWIO_CRYPTO0_CRYPTO_BAM_P_IRQ_EN1_ADDR A:0x60718018
y.create.l HWIO_CRYPTO0_CRYPTO_BAM_P_IRQ_EN2_ADDR A:0x60719018
y.create.l HWIO_CRYPTO0_CRYPTO_BAM_P_IRQ_EN3_ADDR A:0x6071a018
y.create.l HWIO_CRYPTO0_CRYPTO_BAM_P_IRQ_EN4_ADDR A:0x6071b018
y.create.l HWIO_CRYPTO0_CRYPTO_BAM_P_IRQ_EN5_ADDR A:0x6071c018
y.create.l HWIO_CRYPTO0_CRYPTO_BAM_P_IRQ_EN6_ADDR A:0x6071d018
y.create.l HWIO_CRYPTO0_CRYPTO_BAM_P_IRQ_EN7_ADDR A:0x6071e018
y.create.l HWIO_CRYPTO0_CRYPTO_BAM_P_TIMER0_ADDR A:0x6071701c
y.create.l HWIO_CRYPTO0_CRYPTO_BAM_P_TIMER1_ADDR A:0x6071801c
y.create.l HWIO_CRYPTO0_CRYPTO_BAM_P_TIMER2_ADDR A:0x6071901c
y.create.l HWIO_CRYPTO0_CRYPTO_BAM_P_TIMER3_ADDR A:0x6071a01c
y.create.l HWIO_CRYPTO0_CRYPTO_BAM_P_TIMER4_ADDR A:0x6071b01c
y.create.l HWIO_CRYPTO0_CRYPTO_BAM_P_TIMER5_ADDR A:0x6071c01c
y.create.l HWIO_CRYPTO0_CRYPTO_BAM_P_TIMER6_ADDR A:0x6071d01c
y.create.l HWIO_CRYPTO0_CRYPTO_BAM_P_TIMER7_ADDR A:0x6071e01c
y.create.l HWIO_CRYPTO0_CRYPTO_BAM_P_TIMER_CTRL0_ADDR A:0x60717020
y.create.l HWIO_CRYPTO0_CRYPTO_BAM_P_TIMER_CTRL1_ADDR A:0x60718020
y.create.l HWIO_CRYPTO0_CRYPTO_BAM_P_TIMER_CTRL2_ADDR A:0x60719020
y.create.l HWIO_CRYPTO0_CRYPTO_BAM_P_TIMER_CTRL3_ADDR A:0x6071a020
y.create.l HWIO_CRYPTO0_CRYPTO_BAM_P_TIMER_CTRL4_ADDR A:0x6071b020
y.create.l HWIO_CRYPTO0_CRYPTO_BAM_P_TIMER_CTRL5_ADDR A:0x6071c020
y.create.l HWIO_CRYPTO0_CRYPTO_BAM_P_TIMER_CTRL6_ADDR A:0x6071d020
y.create.l HWIO_CRYPTO0_CRYPTO_BAM_P_TIMER_CTRL7_ADDR A:0x6071e020
y.create.l HWIO_CRYPTO0_CRYPTO_BAM_P_PRDCR_SDBND0_ADDR A:0x60717024
y.create.l HWIO_CRYPTO0_CRYPTO_BAM_P_PRDCR_SDBND1_ADDR A:0x60718024
y.create.l HWIO_CRYPTO0_CRYPTO_BAM_P_PRDCR_SDBND2_ADDR A:0x60719024
y.create.l HWIO_CRYPTO0_CRYPTO_BAM_P_PRDCR_SDBND3_ADDR A:0x6071a024
y.create.l HWIO_CRYPTO0_CRYPTO_BAM_P_PRDCR_SDBND4_ADDR A:0x6071b024
y.create.l HWIO_CRYPTO0_CRYPTO_BAM_P_PRDCR_SDBND5_ADDR A:0x6071c024
y.create.l HWIO_CRYPTO0_CRYPTO_BAM_P_PRDCR_SDBND6_ADDR A:0x6071d024
y.create.l HWIO_CRYPTO0_CRYPTO_BAM_P_PRDCR_SDBND7_ADDR A:0x6071e024
y.create.l HWIO_CRYPTO0_CRYPTO_BAM_P_CNSMR_SDBND0_ADDR A:0x60717028
y.create.l HWIO_CRYPTO0_CRYPTO_BAM_P_CNSMR_SDBND1_ADDR A:0x60718028
y.create.l HWIO_CRYPTO0_CRYPTO_BAM_P_CNSMR_SDBND2_ADDR A:0x60719028
y.create.l HWIO_CRYPTO0_CRYPTO_BAM_P_CNSMR_SDBND3_ADDR A:0x6071a028
y.create.l HWIO_CRYPTO0_CRYPTO_BAM_P_CNSMR_SDBND4_ADDR A:0x6071b028
y.create.l HWIO_CRYPTO0_CRYPTO_BAM_P_CNSMR_SDBND5_ADDR A:0x6071c028
y.create.l HWIO_CRYPTO0_CRYPTO_BAM_P_CNSMR_SDBND6_ADDR A:0x6071d028
y.create.l HWIO_CRYPTO0_CRYPTO_BAM_P_CNSMR_SDBND7_ADDR A:0x6071e028
y.create.l HWIO_CRYPTO0_CRYPTO_BAM_P_SW_OFSTS0_ADDR A:0x60717800
y.create.l HWIO_CRYPTO0_CRYPTO_BAM_P_SW_OFSTS1_ADDR A:0x60718800
y.create.l HWIO_CRYPTO0_CRYPTO_BAM_P_SW_OFSTS2_ADDR A:0x60719800
y.create.l HWIO_CRYPTO0_CRYPTO_BAM_P_SW_OFSTS3_ADDR A:0x6071a800
y.create.l HWIO_CRYPTO0_CRYPTO_BAM_P_SW_OFSTS4_ADDR A:0x6071b800
y.create.l HWIO_CRYPTO0_CRYPTO_BAM_P_SW_OFSTS5_ADDR A:0x6071c800
y.create.l HWIO_CRYPTO0_CRYPTO_BAM_P_SW_OFSTS6_ADDR A:0x6071d800
y.create.l HWIO_CRYPTO0_CRYPTO_BAM_P_SW_OFSTS7_ADDR A:0x6071e800
y.create.l HWIO_CRYPTO0_CRYPTO_BAM_P_AU_PSM_CNTXT_1_0_ADDR A:0x60717804
y.create.l HWIO_CRYPTO0_CRYPTO_BAM_P_AU_PSM_CNTXT_1_1_ADDR A:0x60718804
y.create.l HWIO_CRYPTO0_CRYPTO_BAM_P_AU_PSM_CNTXT_1_2_ADDR A:0x60719804
y.create.l HWIO_CRYPTO0_CRYPTO_BAM_P_AU_PSM_CNTXT_1_3_ADDR A:0x6071a804
y.create.l HWIO_CRYPTO0_CRYPTO_BAM_P_AU_PSM_CNTXT_1_4_ADDR A:0x6071b804
y.create.l HWIO_CRYPTO0_CRYPTO_BAM_P_AU_PSM_CNTXT_1_5_ADDR A:0x6071c804
y.create.l HWIO_CRYPTO0_CRYPTO_BAM_P_AU_PSM_CNTXT_1_6_ADDR A:0x6071d804
y.create.l HWIO_CRYPTO0_CRYPTO_BAM_P_AU_PSM_CNTXT_1_7_ADDR A:0x6071e804
y.create.l HWIO_CRYPTO0_CRYPTO_BAM_P_PSM_CNTXT_2_0_ADDR A:0x60717808
y.create.l HWIO_CRYPTO0_CRYPTO_BAM_P_PSM_CNTXT_2_1_ADDR A:0x60718808
y.create.l HWIO_CRYPTO0_CRYPTO_BAM_P_PSM_CNTXT_2_2_ADDR A:0x60719808
y.create.l HWIO_CRYPTO0_CRYPTO_BAM_P_PSM_CNTXT_2_3_ADDR A:0x6071a808
y.create.l HWIO_CRYPTO0_CRYPTO_BAM_P_PSM_CNTXT_2_4_ADDR A:0x6071b808
y.create.l HWIO_CRYPTO0_CRYPTO_BAM_P_PSM_CNTXT_2_5_ADDR A:0x6071c808
y.create.l HWIO_CRYPTO0_CRYPTO_BAM_P_PSM_CNTXT_2_6_ADDR A:0x6071d808
y.create.l HWIO_CRYPTO0_CRYPTO_BAM_P_PSM_CNTXT_2_7_ADDR A:0x6071e808
y.create.l HWIO_CRYPTO0_CRYPTO_BAM_P_PSM_CNTXT_3_0_ADDR A:0x6071780c
y.create.l HWIO_CRYPTO0_CRYPTO_BAM_P_PSM_CNTXT_3_1_ADDR A:0x6071880c
y.create.l HWIO_CRYPTO0_CRYPTO_BAM_P_PSM_CNTXT_3_2_ADDR A:0x6071980c
y.create.l HWIO_CRYPTO0_CRYPTO_BAM_P_PSM_CNTXT_3_3_ADDR A:0x6071a80c
y.create.l HWIO_CRYPTO0_CRYPTO_BAM_P_PSM_CNTXT_3_4_ADDR A:0x6071b80c
y.create.l HWIO_CRYPTO0_CRYPTO_BAM_P_PSM_CNTXT_3_5_ADDR A:0x6071c80c
y.create.l HWIO_CRYPTO0_CRYPTO_BAM_P_PSM_CNTXT_3_6_ADDR A:0x6071d80c
y.create.l HWIO_CRYPTO0_CRYPTO_BAM_P_PSM_CNTXT_3_7_ADDR A:0x6071e80c
y.create.l HWIO_CRYPTO0_CRYPTO_BAM_P_PSM_CNTXT_4_0_ADDR A:0x60717810
y.create.l HWIO_CRYPTO0_CRYPTO_BAM_P_PSM_CNTXT_4_1_ADDR A:0x60718810
y.create.l HWIO_CRYPTO0_CRYPTO_BAM_P_PSM_CNTXT_4_2_ADDR A:0x60719810
y.create.l HWIO_CRYPTO0_CRYPTO_BAM_P_PSM_CNTXT_4_3_ADDR A:0x6071a810
y.create.l HWIO_CRYPTO0_CRYPTO_BAM_P_PSM_CNTXT_4_4_ADDR A:0x6071b810
y.create.l HWIO_CRYPTO0_CRYPTO_BAM_P_PSM_CNTXT_4_5_ADDR A:0x6071c810
y.create.l HWIO_CRYPTO0_CRYPTO_BAM_P_PSM_CNTXT_4_6_ADDR A:0x6071d810
y.create.l HWIO_CRYPTO0_CRYPTO_BAM_P_PSM_CNTXT_4_7_ADDR A:0x6071e810
y.create.l HWIO_CRYPTO0_CRYPTO_BAM_P_PSM_CNTXT_5_0_ADDR A:0x60717814
y.create.l HWIO_CRYPTO0_CRYPTO_BAM_P_PSM_CNTXT_5_1_ADDR A:0x60718814
y.create.l HWIO_CRYPTO0_CRYPTO_BAM_P_PSM_CNTXT_5_2_ADDR A:0x60719814
y.create.l HWIO_CRYPTO0_CRYPTO_BAM_P_PSM_CNTXT_5_3_ADDR A:0x6071a814
y.create.l HWIO_CRYPTO0_CRYPTO_BAM_P_PSM_CNTXT_5_4_ADDR A:0x6071b814
y.create.l HWIO_CRYPTO0_CRYPTO_BAM_P_PSM_CNTXT_5_5_ADDR A:0x6071c814
y.create.l HWIO_CRYPTO0_CRYPTO_BAM_P_PSM_CNTXT_5_6_ADDR A:0x6071d814
y.create.l HWIO_CRYPTO0_CRYPTO_BAM_P_PSM_CNTXT_5_7_ADDR A:0x6071e814
y.create.l HWIO_CRYPTO0_CRYPTO_BAM_P_EVNT_REG0_ADDR A:0x60717818
y.create.l HWIO_CRYPTO0_CRYPTO_BAM_P_EVNT_REG1_ADDR A:0x60718818
y.create.l HWIO_CRYPTO0_CRYPTO_BAM_P_EVNT_REG2_ADDR A:0x60719818
y.create.l HWIO_CRYPTO0_CRYPTO_BAM_P_EVNT_REG3_ADDR A:0x6071a818
y.create.l HWIO_CRYPTO0_CRYPTO_BAM_P_EVNT_REG4_ADDR A:0x6071b818
y.create.l HWIO_CRYPTO0_CRYPTO_BAM_P_EVNT_REG5_ADDR A:0x6071c818
y.create.l HWIO_CRYPTO0_CRYPTO_BAM_P_EVNT_REG6_ADDR A:0x6071d818
y.create.l HWIO_CRYPTO0_CRYPTO_BAM_P_EVNT_REG7_ADDR A:0x6071e818
y.create.l HWIO_CRYPTO0_CRYPTO_BAM_P_DESC_FIFO_ADDR0_ADDR A:0x6071781c
y.create.l HWIO_CRYPTO0_CRYPTO_BAM_P_DESC_FIFO_ADDR1_ADDR A:0x6071881c
y.create.l HWIO_CRYPTO0_CRYPTO_BAM_P_DESC_FIFO_ADDR2_ADDR A:0x6071981c
y.create.l HWIO_CRYPTO0_CRYPTO_BAM_P_DESC_FIFO_ADDR3_ADDR A:0x6071a81c
y.create.l HWIO_CRYPTO0_CRYPTO_BAM_P_DESC_FIFO_ADDR4_ADDR A:0x6071b81c
y.create.l HWIO_CRYPTO0_CRYPTO_BAM_P_DESC_FIFO_ADDR5_ADDR A:0x6071c81c
y.create.l HWIO_CRYPTO0_CRYPTO_BAM_P_DESC_FIFO_ADDR6_ADDR A:0x6071d81c
y.create.l HWIO_CRYPTO0_CRYPTO_BAM_P_DESC_FIFO_ADDR7_ADDR A:0x6071e81c
y.create.l HWIO_CRYPTO0_CRYPTO_BAM_P_FIFO_SIZES0_ADDR A:0x60717820
y.create.l HWIO_CRYPTO0_CRYPTO_BAM_P_FIFO_SIZES1_ADDR A:0x60718820
y.create.l HWIO_CRYPTO0_CRYPTO_BAM_P_FIFO_SIZES2_ADDR A:0x60719820
y.create.l HWIO_CRYPTO0_CRYPTO_BAM_P_FIFO_SIZES3_ADDR A:0x6071a820
y.create.l HWIO_CRYPTO0_CRYPTO_BAM_P_FIFO_SIZES4_ADDR A:0x6071b820
y.create.l HWIO_CRYPTO0_CRYPTO_BAM_P_FIFO_SIZES5_ADDR A:0x6071c820
y.create.l HWIO_CRYPTO0_CRYPTO_BAM_P_FIFO_SIZES6_ADDR A:0x6071d820
y.create.l HWIO_CRYPTO0_CRYPTO_BAM_P_FIFO_SIZES7_ADDR A:0x6071e820
y.create.l HWIO_CRYPTO0_CRYPTO_BAM_P_DATA_FIFO_ADDR0_ADDR A:0x60717824
y.create.l HWIO_CRYPTO0_CRYPTO_BAM_P_DATA_FIFO_ADDR1_ADDR A:0x60718824
y.create.l HWIO_CRYPTO0_CRYPTO_BAM_P_DATA_FIFO_ADDR2_ADDR A:0x60719824
y.create.l HWIO_CRYPTO0_CRYPTO_BAM_P_DATA_FIFO_ADDR3_ADDR A:0x6071a824
y.create.l HWIO_CRYPTO0_CRYPTO_BAM_P_DATA_FIFO_ADDR4_ADDR A:0x6071b824
y.create.l HWIO_CRYPTO0_CRYPTO_BAM_P_DATA_FIFO_ADDR5_ADDR A:0x6071c824
y.create.l HWIO_CRYPTO0_CRYPTO_BAM_P_DATA_FIFO_ADDR6_ADDR A:0x6071d824
y.create.l HWIO_CRYPTO0_CRYPTO_BAM_P_DATA_FIFO_ADDR7_ADDR A:0x6071e824
y.create.l HWIO_CRYPTO0_CRYPTO_BAM_P_EVNT_GEN_TRSHLD0_ADDR A:0x60717828
y.create.l HWIO_CRYPTO0_CRYPTO_BAM_P_EVNT_GEN_TRSHLD1_ADDR A:0x60718828
y.create.l HWIO_CRYPTO0_CRYPTO_BAM_P_EVNT_GEN_TRSHLD2_ADDR A:0x60719828
y.create.l HWIO_CRYPTO0_CRYPTO_BAM_P_EVNT_GEN_TRSHLD3_ADDR A:0x6071a828
y.create.l HWIO_CRYPTO0_CRYPTO_BAM_P_EVNT_GEN_TRSHLD4_ADDR A:0x6071b828
y.create.l HWIO_CRYPTO0_CRYPTO_BAM_P_EVNT_GEN_TRSHLD5_ADDR A:0x6071c828
y.create.l HWIO_CRYPTO0_CRYPTO_BAM_P_EVNT_GEN_TRSHLD6_ADDR A:0x6071d828
y.create.l HWIO_CRYPTO0_CRYPTO_BAM_P_EVNT_GEN_TRSHLD7_ADDR A:0x6071e828
y.create.l HWIO_CRYPTO0_CRYPTO_BAM_P_EVNT_DEST_ADDR0_ADDR A:0x6071782c
y.create.l HWIO_CRYPTO0_CRYPTO_BAM_P_EVNT_DEST_ADDR1_ADDR A:0x6071882c
y.create.l HWIO_CRYPTO0_CRYPTO_BAM_P_EVNT_DEST_ADDR2_ADDR A:0x6071982c
y.create.l HWIO_CRYPTO0_CRYPTO_BAM_P_EVNT_DEST_ADDR3_ADDR A:0x6071a82c
y.create.l HWIO_CRYPTO0_CRYPTO_BAM_P_EVNT_DEST_ADDR4_ADDR A:0x6071b82c
y.create.l HWIO_CRYPTO0_CRYPTO_BAM_P_EVNT_DEST_ADDR5_ADDR A:0x6071c82c
y.create.l HWIO_CRYPTO0_CRYPTO_BAM_P_EVNT_DEST_ADDR6_ADDR A:0x6071d82c
y.create.l HWIO_CRYPTO0_CRYPTO_BAM_P_EVNT_DEST_ADDR7_ADDR A:0x6071e82c
y.create.l HWIO_CRYPTO0_CRYPTO_BAM_P_DF_CNTXT_0_ADDR A:0x60717830
y.create.l HWIO_CRYPTO0_CRYPTO_BAM_P_DF_CNTXT_1_ADDR A:0x60718830
y.create.l HWIO_CRYPTO0_CRYPTO_BAM_P_DF_CNTXT_2_ADDR A:0x60719830
y.create.l HWIO_CRYPTO0_CRYPTO_BAM_P_DF_CNTXT_3_ADDR A:0x6071a830
y.create.l HWIO_CRYPTO0_CRYPTO_BAM_P_DF_CNTXT_4_ADDR A:0x6071b830
y.create.l HWIO_CRYPTO0_CRYPTO_BAM_P_DF_CNTXT_5_ADDR A:0x6071c830
y.create.l HWIO_CRYPTO0_CRYPTO_BAM_P_DF_CNTXT_6_ADDR A:0x6071d830
y.create.l HWIO_CRYPTO0_CRYPTO_BAM_P_DF_CNTXT_7_ADDR A:0x6071e830
y.create.l HWIO_CRYPTO0_CRYPTO_BAM_P_RETR_CNTXT_0_ADDR A:0x60717834
y.create.l HWIO_CRYPTO0_CRYPTO_BAM_P_RETR_CNTXT_1_ADDR A:0x60718834
y.create.l HWIO_CRYPTO0_CRYPTO_BAM_P_RETR_CNTXT_2_ADDR A:0x60719834
y.create.l HWIO_CRYPTO0_CRYPTO_BAM_P_RETR_CNTXT_3_ADDR A:0x6071a834
y.create.l HWIO_CRYPTO0_CRYPTO_BAM_P_RETR_CNTXT_4_ADDR A:0x6071b834
y.create.l HWIO_CRYPTO0_CRYPTO_BAM_P_RETR_CNTXT_5_ADDR A:0x6071c834
y.create.l HWIO_CRYPTO0_CRYPTO_BAM_P_RETR_CNTXT_6_ADDR A:0x6071d834
y.create.l HWIO_CRYPTO0_CRYPTO_BAM_P_RETR_CNTXT_7_ADDR A:0x6071e834
y.create.l HWIO_CRYPTO0_CRYPTO_BAM_P_SI_CNTXT_0_ADDR A:0x60717838
y.create.l HWIO_CRYPTO0_CRYPTO_BAM_P_SI_CNTXT_1_ADDR A:0x60718838
y.create.l HWIO_CRYPTO0_CRYPTO_BAM_P_SI_CNTXT_2_ADDR A:0x60719838
y.create.l HWIO_CRYPTO0_CRYPTO_BAM_P_SI_CNTXT_3_ADDR A:0x6071a838
y.create.l HWIO_CRYPTO0_CRYPTO_BAM_P_SI_CNTXT_4_ADDR A:0x6071b838
y.create.l HWIO_CRYPTO0_CRYPTO_BAM_P_SI_CNTXT_5_ADDR A:0x6071c838
y.create.l HWIO_CRYPTO0_CRYPTO_BAM_P_SI_CNTXT_6_ADDR A:0x6071d838
y.create.l HWIO_CRYPTO0_CRYPTO_BAM_P_SI_CNTXT_7_ADDR A:0x6071e838
y.create.l HWIO_CRYPTO0_CRYPTO_BAM_P_PSM_CNTXT_3_LSB0_ADDR A:0x60717900
y.create.l HWIO_CRYPTO0_CRYPTO_BAM_P_PSM_CNTXT_3_LSB1_ADDR A:0x60718900
y.create.l HWIO_CRYPTO0_CRYPTO_BAM_P_PSM_CNTXT_3_LSB2_ADDR A:0x60719900
y.create.l HWIO_CRYPTO0_CRYPTO_BAM_P_PSM_CNTXT_3_LSB3_ADDR A:0x6071a900
y.create.l HWIO_CRYPTO0_CRYPTO_BAM_P_PSM_CNTXT_3_LSB4_ADDR A:0x6071b900
y.create.l HWIO_CRYPTO0_CRYPTO_BAM_P_PSM_CNTXT_3_LSB5_ADDR A:0x6071c900
y.create.l HWIO_CRYPTO0_CRYPTO_BAM_P_PSM_CNTXT_3_LSB6_ADDR A:0x6071d900
y.create.l HWIO_CRYPTO0_CRYPTO_BAM_P_PSM_CNTXT_3_LSB7_ADDR A:0x6071e900
y.create.l HWIO_CRYPTO0_CRYPTO_BAM_P_PSM_CNTXT_3_MSB0_ADDR A:0x60717904
y.create.l HWIO_CRYPTO0_CRYPTO_BAM_P_PSM_CNTXT_3_MSB1_ADDR A:0x60718904
y.create.l HWIO_CRYPTO0_CRYPTO_BAM_P_PSM_CNTXT_3_MSB2_ADDR A:0x60719904
y.create.l HWIO_CRYPTO0_CRYPTO_BAM_P_PSM_CNTXT_3_MSB3_ADDR A:0x6071a904
y.create.l HWIO_CRYPTO0_CRYPTO_BAM_P_PSM_CNTXT_3_MSB4_ADDR A:0x6071b904
y.create.l HWIO_CRYPTO0_CRYPTO_BAM_P_PSM_CNTXT_3_MSB5_ADDR A:0x6071c904
y.create.l HWIO_CRYPTO0_CRYPTO_BAM_P_PSM_CNTXT_3_MSB6_ADDR A:0x6071d904
y.create.l HWIO_CRYPTO0_CRYPTO_BAM_P_PSM_CNTXT_3_MSB7_ADDR A:0x6071e904
y.create.l HWIO_CRYPTO0_CRYPTO_BAM_P_DESC_FIFO_ADDR_LSB0_ADDR A:0x60717910
y.create.l HWIO_CRYPTO0_CRYPTO_BAM_P_DESC_FIFO_ADDR_LSB1_ADDR A:0x60718910
y.create.l HWIO_CRYPTO0_CRYPTO_BAM_P_DESC_FIFO_ADDR_LSB2_ADDR A:0x60719910
y.create.l HWIO_CRYPTO0_CRYPTO_BAM_P_DESC_FIFO_ADDR_LSB3_ADDR A:0x6071a910
y.create.l HWIO_CRYPTO0_CRYPTO_BAM_P_DESC_FIFO_ADDR_LSB4_ADDR A:0x6071b910
y.create.l HWIO_CRYPTO0_CRYPTO_BAM_P_DESC_FIFO_ADDR_LSB5_ADDR A:0x6071c910
y.create.l HWIO_CRYPTO0_CRYPTO_BAM_P_DESC_FIFO_ADDR_LSB6_ADDR A:0x6071d910
y.create.l HWIO_CRYPTO0_CRYPTO_BAM_P_DESC_FIFO_ADDR_LSB7_ADDR A:0x6071e910
y.create.l HWIO_CRYPTO0_CRYPTO_BAM_P_DESC_FIFO_ADDR_MSB0_ADDR A:0x60717914
y.create.l HWIO_CRYPTO0_CRYPTO_BAM_P_DESC_FIFO_ADDR_MSB1_ADDR A:0x60718914
y.create.l HWIO_CRYPTO0_CRYPTO_BAM_P_DESC_FIFO_ADDR_MSB2_ADDR A:0x60719914
y.create.l HWIO_CRYPTO0_CRYPTO_BAM_P_DESC_FIFO_ADDR_MSB3_ADDR A:0x6071a914
y.create.l HWIO_CRYPTO0_CRYPTO_BAM_P_DESC_FIFO_ADDR_MSB4_ADDR A:0x6071b914
y.create.l HWIO_CRYPTO0_CRYPTO_BAM_P_DESC_FIFO_ADDR_MSB5_ADDR A:0x6071c914
y.create.l HWIO_CRYPTO0_CRYPTO_BAM_P_DESC_FIFO_ADDR_MSB6_ADDR A:0x6071d914
y.create.l HWIO_CRYPTO0_CRYPTO_BAM_P_DESC_FIFO_ADDR_MSB7_ADDR A:0x6071e914
y.create.l HWIO_CRYPTO0_CRYPTO_BAM_P_DATA_FIFO_ADDR_LSB0_ADDR A:0x60717920
y.create.l HWIO_CRYPTO0_CRYPTO_BAM_P_DATA_FIFO_ADDR_LSB1_ADDR A:0x60718920
y.create.l HWIO_CRYPTO0_CRYPTO_BAM_P_DATA_FIFO_ADDR_LSB2_ADDR A:0x60719920
y.create.l HWIO_CRYPTO0_CRYPTO_BAM_P_DATA_FIFO_ADDR_LSB3_ADDR A:0x6071a920
y.create.l HWIO_CRYPTO0_CRYPTO_BAM_P_DATA_FIFO_ADDR_LSB4_ADDR A:0x6071b920
y.create.l HWIO_CRYPTO0_CRYPTO_BAM_P_DATA_FIFO_ADDR_LSB5_ADDR A:0x6071c920
y.create.l HWIO_CRYPTO0_CRYPTO_BAM_P_DATA_FIFO_ADDR_LSB6_ADDR A:0x6071d920
y.create.l HWIO_CRYPTO0_CRYPTO_BAM_P_DATA_FIFO_ADDR_LSB7_ADDR A:0x6071e920
y.create.l HWIO_CRYPTO0_CRYPTO_BAM_P_DATA_FIFO_ADDR_MSB0_ADDR A:0x60717924
y.create.l HWIO_CRYPTO0_CRYPTO_BAM_P_DATA_FIFO_ADDR_MSB1_ADDR A:0x60718924
y.create.l HWIO_CRYPTO0_CRYPTO_BAM_P_DATA_FIFO_ADDR_MSB2_ADDR A:0x60719924
y.create.l HWIO_CRYPTO0_CRYPTO_BAM_P_DATA_FIFO_ADDR_MSB3_ADDR A:0x6071a924
y.create.l HWIO_CRYPTO0_CRYPTO_BAM_P_DATA_FIFO_ADDR_MSB4_ADDR A:0x6071b924
y.create.l HWIO_CRYPTO0_CRYPTO_BAM_P_DATA_FIFO_ADDR_MSB5_ADDR A:0x6071c924
y.create.l HWIO_CRYPTO0_CRYPTO_BAM_P_DATA_FIFO_ADDR_MSB6_ADDR A:0x6071d924
y.create.l HWIO_CRYPTO0_CRYPTO_BAM_P_DATA_FIFO_ADDR_MSB7_ADDR A:0x6071e924
y.create.l HWIO_CRYPTO0_CRYPTO_BAM_P_EVNT_DEST_ADDR_LSB0_ADDR A:0x60717930
y.create.l HWIO_CRYPTO0_CRYPTO_BAM_P_EVNT_DEST_ADDR_LSB1_ADDR A:0x60718930
y.create.l HWIO_CRYPTO0_CRYPTO_BAM_P_EVNT_DEST_ADDR_LSB2_ADDR A:0x60719930
y.create.l HWIO_CRYPTO0_CRYPTO_BAM_P_EVNT_DEST_ADDR_LSB3_ADDR A:0x6071a930
y.create.l HWIO_CRYPTO0_CRYPTO_BAM_P_EVNT_DEST_ADDR_LSB4_ADDR A:0x6071b930
y.create.l HWIO_CRYPTO0_CRYPTO_BAM_P_EVNT_DEST_ADDR_LSB5_ADDR A:0x6071c930
y.create.l HWIO_CRYPTO0_CRYPTO_BAM_P_EVNT_DEST_ADDR_LSB6_ADDR A:0x6071d930
y.create.l HWIO_CRYPTO0_CRYPTO_BAM_P_EVNT_DEST_ADDR_LSB7_ADDR A:0x6071e930
y.create.l HWIO_CRYPTO0_CRYPTO_BAM_P_EVNT_DEST_ADDR_MSB0_ADDR A:0x60717934
y.create.l HWIO_CRYPTO0_CRYPTO_BAM_P_EVNT_DEST_ADDR_MSB1_ADDR A:0x60718934
y.create.l HWIO_CRYPTO0_CRYPTO_BAM_P_EVNT_DEST_ADDR_MSB2_ADDR A:0x60719934
y.create.l HWIO_CRYPTO0_CRYPTO_BAM_P_EVNT_DEST_ADDR_MSB3_ADDR A:0x6071a934
y.create.l HWIO_CRYPTO0_CRYPTO_BAM_P_EVNT_DEST_ADDR_MSB4_ADDR A:0x6071b934
y.create.l HWIO_CRYPTO0_CRYPTO_BAM_P_EVNT_DEST_ADDR_MSB5_ADDR A:0x6071c934
y.create.l HWIO_CRYPTO0_CRYPTO_BAM_P_EVNT_DEST_ADDR_MSB6_ADDR A:0x6071d934
y.create.l HWIO_CRYPTO0_CRYPTO_BAM_P_EVNT_DEST_ADDR_MSB7_ADDR A:0x6071e934
y.create.l HWIO_CRYPTO0_CRYPTO_BAM_XPU_SCR_ADDR A:0x60702000
y.create.l HWIO_CRYPTO0_CRYPTO_BAM_XPU_SWDR_ADDR A:0x60702004
y.create.l HWIO_CRYPTO0_CRYPTO_BAM_XPU_SEAR0_ADDR A:0x60702040
y.create.l HWIO_CRYPTO0_CRYPTO_BAM_XPU_SESR_ADDR A:0x60702048
y.create.l HWIO_CRYPTO0_CRYPTO_BAM_XPU_SESRRESTORE_ADDR A:0x6070204c
y.create.l HWIO_CRYPTO0_CRYPTO_BAM_XPU_SESYNR0_ADDR A:0x60702050
y.create.l HWIO_CRYPTO0_CRYPTO_BAM_XPU_SESYNR1_ADDR A:0x60702054
y.create.l HWIO_CRYPTO0_CRYPTO_BAM_XPU_SESYNR2_ADDR A:0x60702058
y.create.l HWIO_CRYPTO0_CRYPTO_BAM_XPU_MCR_ADDR A:0x60702100
y.create.l HWIO_CRYPTO0_CRYPTO_BAM_XPU_MEAR0_ADDR A:0x60702140
y.create.l HWIO_CRYPTO0_CRYPTO_BAM_XPU_MESR_ADDR A:0x60702148
y.create.l HWIO_CRYPTO0_CRYPTO_BAM_XPU_MESRRESTORE_ADDR A:0x6070214c
y.create.l HWIO_CRYPTO0_CRYPTO_BAM_XPU_MESYNR0_ADDR A:0x60702150
y.create.l HWIO_CRYPTO0_CRYPTO_BAM_XPU_MESYNR1_ADDR A:0x60702154
y.create.l HWIO_CRYPTO0_CRYPTO_BAM_XPU_MESYNR2_ADDR A:0x60702158
y.create.l HWIO_CRYPTO0_CRYPTO_BAM_XPU_CR_ADDR A:0x60702080
y.create.l HWIO_CRYPTO0_CRYPTO_BAM_XPU_RPU_ACR0_ADDR A:0x607020a0
y.create.l HWIO_CRYPTO0_CRYPTO_BAM_XPU_EAR0_ADDR A:0x607020c0
y.create.l HWIO_CRYPTO0_CRYPTO_BAM_XPU_ESR_ADDR A:0x607020c8
y.create.l HWIO_CRYPTO0_CRYPTO_BAM_XPU_ESRRESTORE_ADDR A:0x607020cc
y.create.l HWIO_CRYPTO0_CRYPTO_BAM_XPU_ESYNR0_ADDR A:0x607020d0
y.create.l HWIO_CRYPTO0_CRYPTO_BAM_XPU_ESYNR1_ADDR A:0x607020d4
y.create.l HWIO_CRYPTO0_CRYPTO_BAM_XPU_ESYNR2_ADDR A:0x607020d8
y.create.l HWIO_CRYPTO0_CRYPTO_BAM_XPU_IDR0_ADDR A:0x60702074
y.create.l HWIO_CRYPTO0_CRYPTO_BAM_XPU_IDR1_ADDR A:0x60702078
y.create.l HWIO_CRYPTO0_CRYPTO_BAM_XPU_REV_ADDR A:0x6070207c
y.create.l HWIO_CRYPTO0_CRYPTO_BAM_XPU_RG0_RACR0_ADDR A:0x60702200
y.create.l HWIO_CRYPTO0_CRYPTO_BAM_XPU_RG1_RACR0_ADDR A:0x60702280
y.create.l HWIO_CRYPTO0_CRYPTO_BAM_XPU_RG2_RACR0_ADDR A:0x60702300
y.create.l HWIO_CRYPTO0_CRYPTO_BAM_XPU_RG3_RACR0_ADDR A:0x60702380
y.create.l HWIO_CRYPTO0_CRYPTO_BAM_XPU_RG4_RACR0_ADDR A:0x60702400
y.create.l HWIO_CRYPTO0_CRYPTO_BAM_XPU_RG5_RACR0_ADDR A:0x60702480
y.create.l HWIO_CRYPTO0_CRYPTO_BAM_XPU_RG6_RACR0_ADDR A:0x60702500
y.create.l HWIO_CRYPTO0_CRYPTO_BAM_XPU_RG7_RACR0_ADDR A:0x60702580
y.create.l HWIO_CRYPTO0_CRYPTO_BAM_XPU_RG8_RACR0_ADDR A:0x60702600
y.create.l HWIO_CRYPTO0_CRYPTO_BAM_XPU_RG9_RACR0_ADDR A:0x60702680
y.create.l HWIO_CRYPTO0_CRYPTO_BAM_XPU_RG0_SCR_ADDR A:0x60702250
y.create.l HWIO_CRYPTO0_CRYPTO_BAM_XPU_RG1_SCR_ADDR A:0x607022d0
y.create.l HWIO_CRYPTO0_CRYPTO_BAM_XPU_RG2_SCR_ADDR A:0x60702350
y.create.l HWIO_CRYPTO0_CRYPTO_BAM_XPU_RG3_SCR_ADDR A:0x607023d0
y.create.l HWIO_CRYPTO0_CRYPTO_BAM_XPU_RG4_SCR_ADDR A:0x60702450
y.create.l HWIO_CRYPTO0_CRYPTO_BAM_XPU_RG5_SCR_ADDR A:0x607024d0
y.create.l HWIO_CRYPTO0_CRYPTO_BAM_XPU_RG6_SCR_ADDR A:0x60702550
y.create.l HWIO_CRYPTO0_CRYPTO_BAM_XPU_RG7_SCR_ADDR A:0x607025d0
y.create.l HWIO_CRYPTO0_CRYPTO_BAM_XPU_RG8_SCR_ADDR A:0x60702650
y.create.l HWIO_CRYPTO0_CRYPTO_BAM_XPU_RG9_SCR_ADDR A:0x607026d0
y.create.l HWIO_CRYPTO0_CRYPTO_BAM_XPU_RG0_MCR_ADDR A:0x60702254
y.create.l HWIO_CRYPTO0_CRYPTO_BAM_XPU_RG1_MCR_ADDR A:0x607022d4
y.create.l HWIO_CRYPTO0_CRYPTO_BAM_XPU_RG2_MCR_ADDR A:0x60702354
y.create.l HWIO_CRYPTO0_CRYPTO_BAM_XPU_RG3_MCR_ADDR A:0x607023d4
y.create.l HWIO_CRYPTO0_CRYPTO_BAM_XPU_RG4_MCR_ADDR A:0x60702454
y.create.l HWIO_CRYPTO0_CRYPTO_BAM_XPU_RG5_MCR_ADDR A:0x607024d4
y.create.l HWIO_CRYPTO0_CRYPTO_BAM_XPU_RG6_MCR_ADDR A:0x60702554
y.create.l HWIO_CRYPTO0_CRYPTO_BAM_XPU_RG7_MCR_ADDR A:0x607025d4
y.create.l HWIO_CRYPTO0_CRYPTO_BAM_XPU_RG8_MCR_ADDR A:0x60702654
y.create.l HWIO_CRYPTO0_CRYPTO_BAM_XPU_RG9_MCR_ADDR A:0x607026d4
y.create.l HWIO_CRYPTO0_CRYPTO_BAM_VMIDMT_SCR0_ADDR A:0x60700000
y.create.l HWIO_CRYPTO0_CRYPTO_BAM_VMIDMT_SCR1_ADDR A:0x60700004
y.create.l HWIO_CRYPTO0_CRYPTO_BAM_VMIDMT_SCR2_ADDR A:0x60700008
y.create.l HWIO_CRYPTO0_CRYPTO_BAM_VMIDMT_SACR_ADDR A:0x60700010
y.create.l HWIO_CRYPTO0_CRYPTO_BAM_VMIDMT_SIDR0_ADDR A:0x60700020
y.create.l HWIO_CRYPTO0_CRYPTO_BAM_VMIDMT_SIDR1_ADDR A:0x60700024
y.create.l HWIO_CRYPTO0_CRYPTO_BAM_VMIDMT_SIDR2_ADDR A:0x60700028
y.create.l HWIO_CRYPTO0_CRYPTO_BAM_VMIDMT_SIDR4_ADDR A:0x60700030
y.create.l HWIO_CRYPTO0_CRYPTO_BAM_VMIDMT_SIDR5_ADDR A:0x60700034
y.create.l HWIO_CRYPTO0_CRYPTO_BAM_VMIDMT_SIDR7_ADDR A:0x6070003c
y.create.l HWIO_CRYPTO0_CRYPTO_BAM_VMIDMT_SGFAR0_ADDR A:0x60700040
y.create.l HWIO_CRYPTO0_CRYPTO_BAM_VMIDMT_SGFSR_ADDR A:0x60700048
y.create.l HWIO_CRYPTO0_CRYPTO_BAM_VMIDMT_SGFSRRESTORE_ADDR A:0x6070004c
y.create.l HWIO_CRYPTO0_CRYPTO_BAM_VMIDMT_SGFSYNDR0_ADDR A:0x60700050
y.create.l HWIO_CRYPTO0_CRYPTO_BAM_VMIDMT_SGFSYNDR1_ADDR A:0x60700054
y.create.l HWIO_CRYPTO0_CRYPTO_BAM_VMIDMT_SGFSYNDR2_ADDR A:0x60700058
y.create.l HWIO_CRYPTO0_CRYPTO_BAM_VMIDMT_VMIDMTSCR0_ADDR A:0x60700090
y.create.l HWIO_CRYPTO0_CRYPTO_BAM_VMIDMT_CR0_ADDR A:0x60700000
y.create.l HWIO_CRYPTO0_CRYPTO_BAM_VMIDMT_CR2_ADDR A:0x60700008
y.create.l HWIO_CRYPTO0_CRYPTO_BAM_VMIDMT_ACR_ADDR A:0x60700010
y.create.l HWIO_CRYPTO0_CRYPTO_BAM_VMIDMT_IDR0_ADDR A:0x60700020
y.create.l HWIO_CRYPTO0_CRYPTO_BAM_VMIDMT_IDR1_ADDR A:0x60700024
y.create.l HWIO_CRYPTO0_CRYPTO_BAM_VMIDMT_IDR2_ADDR A:0x60700028
y.create.l HWIO_CRYPTO0_CRYPTO_BAM_VMIDMT_IDR4_ADDR A:0x60700030
y.create.l HWIO_CRYPTO0_CRYPTO_BAM_VMIDMT_IDR5_ADDR A:0x60700034
y.create.l HWIO_CRYPTO0_CRYPTO_BAM_VMIDMT_IDR7_ADDR A:0x6070003c
y.create.l HWIO_CRYPTO0_CRYPTO_BAM_VMIDMT_GFAR0_ADDR A:0x60700040
y.create.l HWIO_CRYPTO0_CRYPTO_BAM_VMIDMT_GFSR_ADDR A:0x60700048
y.create.l HWIO_CRYPTO0_CRYPTO_BAM_VMIDMT_GFSRRESTORE_ADDR A:0x6070004c
y.create.l HWIO_CRYPTO0_CRYPTO_BAM_VMIDMT_GFSYNDR0_ADDR A:0x60700050
y.create.l HWIO_CRYPTO0_CRYPTO_BAM_VMIDMT_GFSYNDR1_ADDR A:0x60700054
y.create.l HWIO_CRYPTO0_CRYPTO_BAM_VMIDMT_GFSYNDR2_ADDR A:0x60700058
y.create.l HWIO_CRYPTO0_CRYPTO_BAM_VMIDMT_VMIDMTCR0_ADDR A:0x60700090
y.create.l HWIO_CRYPTO0_CRYPTO_BAM_VMIDMT_VMIDMTACR_ADDR A:0x6070009c
y.create.l HWIO_CRYPTO0_CRYPTO_BAM_VMIDMT_NSCR0_ADDR A:0x60700400
y.create.l HWIO_CRYPTO0_CRYPTO_BAM_VMIDMT_NSCR2_ADDR A:0x60700408
y.create.l HWIO_CRYPTO0_CRYPTO_BAM_VMIDMT_NSACR_ADDR A:0x60700410
y.create.l HWIO_CRYPTO0_CRYPTO_BAM_VMIDMT_NSGFAR0_ADDR A:0x60700440
y.create.l HWIO_CRYPTO0_CRYPTO_BAM_VMIDMT_NSGFSR_ADDR A:0x60700448
y.create.l HWIO_CRYPTO0_CRYPTO_BAM_VMIDMT_NSGFSRRESTORE_ADDR A:0x6070044c
y.create.l HWIO_CRYPTO0_CRYPTO_BAM_VMIDMT_NSGFSYNDR0_ADDR A:0x60700450
y.create.l HWIO_CRYPTO0_CRYPTO_BAM_VMIDMT_NSGFSYNDR1_ADDR A:0x60700454
y.create.l HWIO_CRYPTO0_CRYPTO_BAM_VMIDMT_NSGFSYNDR2_ADDR A:0x60700458
y.create.l HWIO_CRYPTO0_CRYPTO_BAM_VMIDMT_NSVMIDMTCR0_ADDR A:0x60700490
y.create.l HWIO_CRYPTO0_CRYPTO_BAM_VMIDMT_SSDR0_ADDR A:0x60700080
y.create.l HWIO_CRYPTO0_CRYPTO_BAM_VMIDMT_MSDR0_ADDR A:0x60700480
y.create.l HWIO_CRYPTO0_CRYPTO_BAM_VMIDMT_MCR_ADDR A:0x60700494
y.create.l HWIO_CRYPTO0_CRYPTO_BAM_VMIDMT_S2VR0_ADDR A:0x60700c00
y.create.l HWIO_CRYPTO0_CRYPTO_BAM_VMIDMT_S2VR1_ADDR A:0x60700c04
y.create.l HWIO_CRYPTO0_CRYPTO_BAM_VMIDMT_S2VR2_ADDR A:0x60700c08
y.create.l HWIO_CRYPTO0_CRYPTO_BAM_VMIDMT_S2VR3_ADDR A:0x60700c0c
y.create.l HWIO_CRYPTO0_CRYPTO_BAM_VMIDMT_S2VR4_ADDR A:0x60700c10
y.create.l HWIO_CRYPTO0_CRYPTO_BAM_VMIDMT_S2VR5_ADDR A:0x60700c14
y.create.l HWIO_CRYPTO0_CRYPTO_BAM_VMIDMT_S2VR6_ADDR A:0x60700c18
y.create.l HWIO_CRYPTO0_CRYPTO_BAM_VMIDMT_S2VR7_ADDR A:0x60700c1c
y.create.l HWIO_CRYPTO0_CRYPTO_BAM_VMIDMT_S2VR8_ADDR A:0x60700c20
y.create.l HWIO_CRYPTO0_CRYPTO_BAM_VMIDMT_AS2VR0_ADDR A:0x60700e00
y.create.l HWIO_CRYPTO0_CRYPTO_BAM_VMIDMT_AS2VR1_ADDR A:0x60700e04
y.create.l HWIO_CRYPTO0_CRYPTO_BAM_VMIDMT_AS2VR2_ADDR A:0x60700e08
y.create.l HWIO_CRYPTO0_CRYPTO_BAM_VMIDMT_AS2VR3_ADDR A:0x60700e0c
y.create.l HWIO_CRYPTO0_CRYPTO_BAM_VMIDMT_AS2VR4_ADDR A:0x60700e10
y.create.l HWIO_CRYPTO0_CRYPTO_BAM_VMIDMT_AS2VR5_ADDR A:0x60700e14
y.create.l HWIO_CRYPTO0_CRYPTO_BAM_VMIDMT_AS2VR6_ADDR A:0x60700e18
y.create.l HWIO_CRYPTO0_CRYPTO_BAM_VMIDMT_AS2VR7_ADDR A:0x60700e1c
y.create.l HWIO_CRYPTO0_CRYPTO_BAM_VMIDMT_AS2VR8_ADDR A:0x60700e20
y.create.l HWIO_CRYPTO0_CRYPTO_BAM_VMIDMT_SMR0_ADDR A:0x60700800
y.create.l HWIO_CRYPTO0_CRYPTO_BAM_VMIDMT_SMR1_ADDR A:0x60700804
y.create.l HWIO_CRYPTO0_CRYPTO_BAM_VMIDMT_SMR2_ADDR A:0x60700808
y.create.l HWIO_CRYPTO0_CRYPTO_BAM_VMIDMT_SMR3_ADDR A:0x6070080c
y.create.l HWIO_CRYPTO0_CRYPTO_BAM_VMIDMT_SMR4_ADDR A:0x60700810
y.create.l HWIO_CRYPTO0_CRYPTO_BAM_VMIDMT_SMR5_ADDR A:0x60700814
y.create.l HWIO_CRYPTO0_CRYPTO_BAM_VMIDMT_SMR6_ADDR A:0x60700818
y.create.l HWIO_CRYPTO0_CRYPTO_BAM_VMIDMT_SMR7_ADDR A:0x6070081c
y.create.l HWIO_CRYPTO0_CRYPTO_BAM_VMIDMT_SMR8_ADDR A:0x60700820
y.create.l HWIO_DEHR_BIMC_DEHR_HW_VERSION_ADDR A:0x604b2000
y.create.l HWIO_DEHR_BIMC_DEHR_HW_INFO_ADDR A:0x604b2004
y.create.l HWIO_DEHR_BIMC_DEHR_CGC_CFG_ADDR A:0x604b2010
y.create.l HWIO_DEHR_BIMC_DEHR_MSA_CFG_ADDR A:0x604b2104
y.create.l HWIO_DEHR_BIMC_DEHR_RAM_CFG_ADDR A:0x604b2140
y.create.l HWIO_DEHR_BIMC_DEHR_DMA_STATUS_ADDR A:0x604b2200
y.create.l HWIO_DEHR_BIMC_DEHR_DBG_CFG_ADDR A:0x604b2400
y.create.l HWIO_DEHR_BIMC_DEHR_SW_DMA_CFG_ADDR A:0x604b2404
y.create.l HWIO_DEHR_BIMC_DEHR_DBG_ADDR_ADDR A:0x604b2408
y.create.l HWIO_DEHR_BIMC_DEHR_SEC_CFG_ADDR A:0x604b3000
y.create.l HWIO_DEHR_XPU_SCR_ADDR A:0x604b0000
y.create.l HWIO_DEHR_XPU_SWDR_ADDR A:0x604b0004
y.create.l HWIO_DEHR_XPU_SEAR0_ADDR A:0x604b0040
y.create.l HWIO_DEHR_XPU_SESR_ADDR A:0x604b0048
y.create.l HWIO_DEHR_XPU_SESRRESTORE_ADDR A:0x604b004c
y.create.l HWIO_DEHR_XPU_SESYNR0_ADDR A:0x604b0050
y.create.l HWIO_DEHR_XPU_SESYNR1_ADDR A:0x604b0054
y.create.l HWIO_DEHR_XPU_SESYNR2_ADDR A:0x604b0058
y.create.l HWIO_DEHR_XPU_MCR_ADDR A:0x604b0100
y.create.l HWIO_DEHR_XPU_MEAR0_ADDR A:0x604b0140
y.create.l HWIO_DEHR_XPU_MESR_ADDR A:0x604b0148
y.create.l HWIO_DEHR_XPU_MESRRESTORE_ADDR A:0x604b014c
y.create.l HWIO_DEHR_XPU_MESYNR0_ADDR A:0x604b0150
y.create.l HWIO_DEHR_XPU_MESYNR1_ADDR A:0x604b0154
y.create.l HWIO_DEHR_XPU_MESYNR2_ADDR A:0x604b0158
y.create.l HWIO_DEHR_XPU_CR_ADDR A:0x604b0080
y.create.l HWIO_DEHR_XPU_RPU_ACR0_ADDR A:0x604b00a0
y.create.l HWIO_DEHR_XPU_EAR0_ADDR A:0x604b00c0
y.create.l HWIO_DEHR_XPU_ESR_ADDR A:0x604b00c8
y.create.l HWIO_DEHR_XPU_ESRRESTORE_ADDR A:0x604b00cc
y.create.l HWIO_DEHR_XPU_ESYNR0_ADDR A:0x604b00d0
y.create.l HWIO_DEHR_XPU_ESYNR1_ADDR A:0x604b00d4
y.create.l HWIO_DEHR_XPU_ESYNR2_ADDR A:0x604b00d8
y.create.l HWIO_DEHR_XPU_IDR0_ADDR A:0x604b0074
y.create.l HWIO_DEHR_XPU_IDR1_ADDR A:0x604b0078
y.create.l HWIO_DEHR_XPU_REV_ADDR A:0x604b007c
y.create.l HWIO_DEHR_XPU_RG0_RACR0_ADDR A:0x604b0200
y.create.l HWIO_DEHR_XPU_RG1_RACR0_ADDR A:0x604b0280
y.create.l HWIO_DEHR_XPU_RG0_SCR_ADDR A:0x604b0250
y.create.l HWIO_DEHR_XPU_RG1_SCR_ADDR A:0x604b02d0
y.create.l HWIO_DEHR_XPU_RG0_MCR_ADDR A:0x604b0254
y.create.l HWIO_DEHR_XPU_RG1_MCR_ADDR A:0x604b02d4
y.create.l HWIO_DEHR_VMIDMT_SCR0_ADDR A:0x604b1000
y.create.l HWIO_DEHR_VMIDMT_SCR1_ADDR A:0x604b1004
y.create.l HWIO_DEHR_VMIDMT_SCR2_ADDR A:0x604b1008
y.create.l HWIO_DEHR_VMIDMT_SACR_ADDR A:0x604b1010
y.create.l HWIO_DEHR_VMIDMT_SIDR0_ADDR A:0x604b1020
y.create.l HWIO_DEHR_VMIDMT_SIDR1_ADDR A:0x604b1024
y.create.l HWIO_DEHR_VMIDMT_SIDR2_ADDR A:0x604b1028
y.create.l HWIO_DEHR_VMIDMT_SIDR4_ADDR A:0x604b1030
y.create.l HWIO_DEHR_VMIDMT_SIDR5_ADDR A:0x604b1034
y.create.l HWIO_DEHR_VMIDMT_SIDR7_ADDR A:0x604b103c
y.create.l HWIO_DEHR_VMIDMT_SGFAR0_ADDR A:0x604b1040
y.create.l HWIO_DEHR_VMIDMT_SGFSR_ADDR A:0x604b1048
y.create.l HWIO_DEHR_VMIDMT_SGFSRRESTORE_ADDR A:0x604b104c
y.create.l HWIO_DEHR_VMIDMT_SGFSYNDR0_ADDR A:0x604b1050
y.create.l HWIO_DEHR_VMIDMT_SGFSYNDR1_ADDR A:0x604b1054
y.create.l HWIO_DEHR_VMIDMT_SGFSYNDR2_ADDR A:0x604b1058
y.create.l HWIO_DEHR_VMIDMT_VMIDMTSCR0_ADDR A:0x604b1090
y.create.l HWIO_DEHR_VMIDMT_CR0_ADDR A:0x604b1000
y.create.l HWIO_DEHR_VMIDMT_CR2_ADDR A:0x604b1008
y.create.l HWIO_DEHR_VMIDMT_ACR_ADDR A:0x604b1010
y.create.l HWIO_DEHR_VMIDMT_IDR0_ADDR A:0x604b1020
y.create.l HWIO_DEHR_VMIDMT_IDR1_ADDR A:0x604b1024
y.create.l HWIO_DEHR_VMIDMT_IDR2_ADDR A:0x604b1028
y.create.l HWIO_DEHR_VMIDMT_IDR4_ADDR A:0x604b1030
y.create.l HWIO_DEHR_VMIDMT_IDR5_ADDR A:0x604b1034
y.create.l HWIO_DEHR_VMIDMT_IDR7_ADDR A:0x604b103c
y.create.l HWIO_DEHR_VMIDMT_GFAR0_ADDR A:0x604b1040
y.create.l HWIO_DEHR_VMIDMT_GFSR_ADDR A:0x604b1048
y.create.l HWIO_DEHR_VMIDMT_GFSRRESTORE_ADDR A:0x604b104c
y.create.l HWIO_DEHR_VMIDMT_GFSYNDR0_ADDR A:0x604b1050
y.create.l HWIO_DEHR_VMIDMT_GFSYNDR1_ADDR A:0x604b1054
y.create.l HWIO_DEHR_VMIDMT_GFSYNDR2_ADDR A:0x604b1058
y.create.l HWIO_DEHR_VMIDMT_VMIDMTCR0_ADDR A:0x604b1090
y.create.l HWIO_DEHR_VMIDMT_VMIDMTACR_ADDR A:0x604b109c
y.create.l HWIO_DEHR_VMIDMT_NSCR0_ADDR A:0x604b1400
y.create.l HWIO_DEHR_VMIDMT_NSCR2_ADDR A:0x604b1408
y.create.l HWIO_DEHR_VMIDMT_NSACR_ADDR A:0x604b1410
y.create.l HWIO_DEHR_VMIDMT_NSGFAR0_ADDR A:0x604b1440
y.create.l HWIO_DEHR_VMIDMT_NSGFSR_ADDR A:0x604b1448
y.create.l HWIO_DEHR_VMIDMT_NSGFSRRESTORE_ADDR A:0x604b144c
y.create.l HWIO_DEHR_VMIDMT_NSGFSYNDR0_ADDR A:0x604b1450
y.create.l HWIO_DEHR_VMIDMT_NSGFSYNDR1_ADDR A:0x604b1454
y.create.l HWIO_DEHR_VMIDMT_NSGFSYNDR2_ADDR A:0x604b1458
y.create.l HWIO_DEHR_VMIDMT_NSVMIDMTCR0_ADDR A:0x604b1490
y.create.l HWIO_DEHR_VMIDMT_SSDR0_ADDR A:0x604b1080
y.create.l HWIO_DEHR_VMIDMT_MSDR0_ADDR A:0x604b1480
y.create.l HWIO_DEHR_VMIDMT_MCR_ADDR A:0x604b1494
y.create.l HWIO_DEHR_VMIDMT_S2VR0_ADDR A:0x604b1c00
y.create.l HWIO_DEHR_VMIDMT_AS2VR0_ADDR A:0x604b1e00
y.create.l HWIO_DIM_C00_DIM_CA_TOP_CFG_ADDR A:0x60480000
y.create.l HWIO_DIM_C00_DIM_CA_HW_INFO_ADDR A:0x60480004
y.create.l HWIO_DIM_C00_DIM_CA_HW_VERSION_ADDR A:0x60480008
y.create.l HWIO_DIM_C00_DIM_CA_PAD_CFG0_ADDR A:0x60480010
y.create.l HWIO_DIM_C00_DIM_CA_PAD_CFG1_ADDR A:0x60480014
y.create.l HWIO_DIM_C00_DIM_CA_PAD_CFG2_ADDR A:0x60480018
y.create.l HWIO_DIM_C00_DIM_CA_PAD_CFG3_ADDR A:0x6048001c
y.create.l HWIO_DIM_C00_DIM_CA_PAD_CFG4_ADDR A:0x60480020
y.create.l HWIO_DIM_C00_DDRPHY_CA_MISR_CFG_ADDR A:0x60480024
y.create.l HWIO_DIM_C00_DDRPHY_CA_MISR_EVEN_STATUS_ADDR A:0x60480028
y.create.l HWIO_DIM_C00_DDRPHY_CA_MISR_ODD_STATUS_ADDR A:0x6048002c
y.create.l HWIO_DIM_C00_DIM_CA_CDC_CTLR_CFG0_ADDR A:0x60480030
y.create.l HWIO_DIM_C00_DIM_CA_CDC_CTLR_CFG1_ADDR A:0x60480034
y.create.l HWIO_DIM_C00_DIM_CA_CDC_CAL_TIMER_CFG0_ADDR A:0x60480038
y.create.l HWIO_DIM_C00_DIM_CA_CDC_CAL_TIMER_CFG1_ADDR A:0x6048003c
y.create.l HWIO_DIM_C00_DIM_CA_CDC_REFCOUNT_CFG_ADDR A:0x60480040
y.create.l HWIO_DIM_C00_DIM_CA_CDC_COARSE_CAL_CFG_ADDR A:0x60480044
y.create.l HWIO_DIM_C00_DIM_CA_CDC_RSVD_CFG_ADDR A:0x60480048
y.create.l HWIO_DIM_C00_DIM_CA_CDC_OFFSET_CFG_ADDR A:0x6048004c
y.create.l HWIO_DIM_C00_DIM_CA_CDC_DELAY_CFG_ADDR A:0x60480050
y.create.l HWIO_DIM_C00_DIM_CA_CDC_SW_MODE_CFG_ADDR A:0x60480054
y.create.l HWIO_DIM_C00_DIM_CA_CDC_TEST_CFG_ADDR A:0x60480058
y.create.l HWIO_DIM_C00_DIM_CA_CDC_SW_OVRD_CFG_ADDR A:0x6048005c
y.create.l HWIO_DIM_C00_DIM_CA_CDC_STATUS0_ADDR A:0x60480070
y.create.l HWIO_DIM_C00_DIM_CA_CDC_STATUS1_ADDR A:0x60480074
y.create.l HWIO_DIM_C00_DIM_CA_CDC_STATUS2_ADDR A:0x60480078
y.create.l HWIO_DIM_C00_DIM_CA_CDC_STATUS3_ADDR A:0x6048007c
y.create.l HWIO_DIM_C00_DIM_CA_IOC_CTLR_CFG_ADDR A:0x604800e0
y.create.l HWIO_DIM_C00_DIM_CA_IOC_CTLR_PNCNT_CFG_ADDR A:0x604800e4
y.create.l HWIO_DIM_C00_DIM_CA_IOC_CTLR_TIMER_CFG_ADDR A:0x604800e8
y.create.l HWIO_DIM_C00_DIM_CA_IOC_CTLR_TIMER_STATUS_ADDR A:0x604800ec
y.create.l HWIO_DIM_C00_DIM_CA_IOC_CTLR_CHAR_CFG_ADDR A:0x604800f0
y.create.l HWIO_DIM_C00_DIM_CA_IOC_CTLR_STATUS_ADDR A:0x604800f4
y.create.l HWIO_DIM_C00_DIM_CA_CA_IOC_SLV_CFG_ADDR A:0x60480100
y.create.l HWIO_DIM_C00_DIM_CA_CA_IOC_SLV_STATUS_ADDR A:0x60480104
y.create.l HWIO_DIM_C00_DIM_CA_CK_IOC_SLV_CFG_ADDR A:0x60480110
y.create.l HWIO_DIM_C00_DIM_CA_CK_IOC_SLV_STATUS_ADDR A:0x60480114
y.create.l HWIO_DIM_D00_DIM_DQ_TOP_CFG_ADDR A:0x60480800
y.create.l HWIO_DIM_D00_DIM_DQ_HW_INFO_ADDR A:0x60480804
y.create.l HWIO_DIM_D00_DIM_DQ_HW_VERSION_ADDR A:0x60480808
y.create.l HWIO_DIM_D00_DIM_DQ_PAD_CFG0_ADDR A:0x60480810
y.create.l HWIO_DIM_D00_DIM_DQ_PAD_CFG1_ADDR A:0x60480814
y.create.l HWIO_DIM_D00_DIM_DQ_PAD_CFG2_ADDR A:0x60480818
y.create.l HWIO_DIM_D00_DIM_DQ_DQ_SMT_STATUS_ADDR A:0x6048081c
y.create.l HWIO_DIM_D00_DIM_DQ_PAD_CFG3_ADDR A:0x60480820
y.create.l HWIO_DIM_D00_DIM_DQ_PAD_CFG4_ADDR A:0x60480824
y.create.l HWIO_DIM_D00_DDRPHY_DQ_MISR_CFG_ADDR A:0x6048080c
y.create.l HWIO_DIM_D00_DDRPHY_DQ_MISR_EVEN_STATUS_ADDR A:0x60480828
y.create.l HWIO_DIM_D00_DDRPHY_DQ_MISR_ODD_STATUS_ADDR A:0x6048082c
y.create.l HWIO_DIM_D00_DIM_DQ_CDC_CTLR_CFG0_ADDR A:0x60480830
y.create.l HWIO_DIM_D00_DIM_DQ_CDC_CTLR_CFG1_ADDR A:0x60480834
y.create.l HWIO_DIM_D00_DIM_DQ_CDC_CAL_TIMER_CFG0_ADDR A:0x60480838
y.create.l HWIO_DIM_D00_DIM_DQ_CDC_CAL_TIMER_CFG1_ADDR A:0x6048083c
y.create.l HWIO_DIM_D00_DIM_DQ_CDC_REFCOUNT_CFG_ADDR A:0x60480840
y.create.l HWIO_DIM_D00_DIM_DQ_CDC_COARSE_CAL_CFG_ADDR A:0x60480844
y.create.l HWIO_DIM_D00_DIM_DQ_CDC_RSVD_CFG_ADDR A:0x60480848
y.create.l HWIO_DIM_D00_DIM_DQ_RD_CDC_OFFSET_CFG_ADDR A:0x6048084c
y.create.l HWIO_DIM_D00_DIM_DQ_RD_CDC_DELAY_CFG_ADDR A:0x60480850
y.create.l HWIO_DIM_D00_DIM_DQ_RD_CDC_SW_MODE_CFG_ADDR A:0x60480854
y.create.l HWIO_DIM_D00_DIM_DQ_RD_CDC_TEST_CFG_ADDR A:0x60480858
y.create.l HWIO_DIM_D00_DIM_DQ_RD_CDC_SW_OVRD_CFG_ADDR A:0x6048085c
y.create.l HWIO_DIM_D00_DIM_DQ_RD_CDC_SLAVE_DDA_CFG_ADDR A:0x60480860
y.create.l HWIO_DIM_D00_DIM_DQ_RD_CDC_STATUS0_ADDR A:0x60480870
y.create.l HWIO_DIM_D00_DIM_DQ_RD_CDC_STATUS1_ADDR A:0x60480874
y.create.l HWIO_DIM_D00_DIM_DQ_RD_CDC_STATUS2_ADDR A:0x60480878
y.create.l HWIO_DIM_D00_DIM_DQ_RD_CDC_STATUS3_ADDR A:0x6048087c
y.create.l HWIO_DIM_D00_DIM_DQ_RD_CDC_STATUS4_ADDR A:0x60480880
y.create.l HWIO_DIM_D00_DIM_DQ_WR_CDC_OFFSET_CFG_ADDR A:0x604808ac
y.create.l HWIO_DIM_D00_DIM_DQ_WR_CDC_DELAY_CFG_ADDR A:0x604808b0
y.create.l HWIO_DIM_D00_DIM_DQ_WR_CDC_SW_MODE_CFG_ADDR A:0x604808b4
y.create.l HWIO_DIM_D00_DIM_DQ_WR_CDC_TEST_CFG_ADDR A:0x604808b8
y.create.l HWIO_DIM_D00_DIM_DQ_WR_CDC_SW_OVRD_CFG_ADDR A:0x604808bc
y.create.l HWIO_DIM_D00_DIM_DQ_WR_CDC_STATUS0_ADDR A:0x604808d0
y.create.l HWIO_DIM_D00_DIM_DQ_WR_CDC_STATUS1_ADDR A:0x604808d4
y.create.l HWIO_DIM_D00_DIM_DQ_WR_CDC_STATUS2_ADDR A:0x604808d8
y.create.l HWIO_DIM_D00_DIM_DQ_WR_CDC_STATUS3_ADDR A:0x604808dc
y.create.l HWIO_DIM_D00_DIM_DQ_DQ_IOC_SLV_CFG_ADDR A:0x60480900
y.create.l HWIO_DIM_D00_DIM_DQ_DQ_IOC_SLV_STATUS_ADDR A:0x60480904
y.create.l HWIO_DIM_D00_DIM_DQ_DQS_IOC_SLV_CFG_ADDR A:0x60480910
y.create.l HWIO_DIM_D00_DIM_DQ_DQS_IOC_SLV_STATUS_ADDR A:0x60480914
y.create.l HWIO_DIM_D01_DIM_DQ_TOP_CFG_ADDR A:0x60481000
y.create.l HWIO_DIM_D01_DIM_DQ_HW_INFO_ADDR A:0x60481004
y.create.l HWIO_DIM_D01_DIM_DQ_HW_VERSION_ADDR A:0x60481008
y.create.l HWIO_DIM_D01_DIM_DQ_PAD_CFG0_ADDR A:0x60481010
y.create.l HWIO_DIM_D01_DIM_DQ_PAD_CFG1_ADDR A:0x60481014
y.create.l HWIO_DIM_D01_DIM_DQ_PAD_CFG2_ADDR A:0x60481018
y.create.l HWIO_DIM_D01_DIM_DQ_DQ_SMT_STATUS_ADDR A:0x6048101c
y.create.l HWIO_DIM_D01_DIM_DQ_PAD_CFG3_ADDR A:0x60481020
y.create.l HWIO_DIM_D01_DIM_DQ_PAD_CFG4_ADDR A:0x60481024
y.create.l HWIO_DIM_D01_DDRPHY_DQ_MISR_CFG_ADDR A:0x6048100c
y.create.l HWIO_DIM_D01_DDRPHY_DQ_MISR_EVEN_STATUS_ADDR A:0x60481028
y.create.l HWIO_DIM_D01_DDRPHY_DQ_MISR_ODD_STATUS_ADDR A:0x6048102c
y.create.l HWIO_DIM_D01_DIM_DQ_CDC_CTLR_CFG0_ADDR A:0x60481030
y.create.l HWIO_DIM_D01_DIM_DQ_CDC_CTLR_CFG1_ADDR A:0x60481034
y.create.l HWIO_DIM_D01_DIM_DQ_CDC_CAL_TIMER_CFG0_ADDR A:0x60481038
y.create.l HWIO_DIM_D01_DIM_DQ_CDC_CAL_TIMER_CFG1_ADDR A:0x6048103c
y.create.l HWIO_DIM_D01_DIM_DQ_CDC_REFCOUNT_CFG_ADDR A:0x60481040
y.create.l HWIO_DIM_D01_DIM_DQ_CDC_COARSE_CAL_CFG_ADDR A:0x60481044
y.create.l HWIO_DIM_D01_DIM_DQ_CDC_RSVD_CFG_ADDR A:0x60481048
y.create.l HWIO_DIM_D01_DIM_DQ_RD_CDC_OFFSET_CFG_ADDR A:0x6048104c
y.create.l HWIO_DIM_D01_DIM_DQ_RD_CDC_DELAY_CFG_ADDR A:0x60481050
y.create.l HWIO_DIM_D01_DIM_DQ_RD_CDC_SW_MODE_CFG_ADDR A:0x60481054
y.create.l HWIO_DIM_D01_DIM_DQ_RD_CDC_TEST_CFG_ADDR A:0x60481058
y.create.l HWIO_DIM_D01_DIM_DQ_RD_CDC_SW_OVRD_CFG_ADDR A:0x6048105c
y.create.l HWIO_DIM_D01_DIM_DQ_RD_CDC_SLAVE_DDA_CFG_ADDR A:0x60481060
y.create.l HWIO_DIM_D01_DIM_DQ_RD_CDC_STATUS0_ADDR A:0x60481070
y.create.l HWIO_DIM_D01_DIM_DQ_RD_CDC_STATUS1_ADDR A:0x60481074
y.create.l HWIO_DIM_D01_DIM_DQ_RD_CDC_STATUS2_ADDR A:0x60481078
y.create.l HWIO_DIM_D01_DIM_DQ_RD_CDC_STATUS3_ADDR A:0x6048107c
y.create.l HWIO_DIM_D01_DIM_DQ_RD_CDC_STATUS4_ADDR A:0x60481080
y.create.l HWIO_DIM_D01_DIM_DQ_WR_CDC_OFFSET_CFG_ADDR A:0x604810ac
y.create.l HWIO_DIM_D01_DIM_DQ_WR_CDC_DELAY_CFG_ADDR A:0x604810b0
y.create.l HWIO_DIM_D01_DIM_DQ_WR_CDC_SW_MODE_CFG_ADDR A:0x604810b4
y.create.l HWIO_DIM_D01_DIM_DQ_WR_CDC_TEST_CFG_ADDR A:0x604810b8
y.create.l HWIO_DIM_D01_DIM_DQ_WR_CDC_SW_OVRD_CFG_ADDR A:0x604810bc
y.create.l HWIO_DIM_D01_DIM_DQ_WR_CDC_STATUS0_ADDR A:0x604810d0
y.create.l HWIO_DIM_D01_DIM_DQ_WR_CDC_STATUS1_ADDR A:0x604810d4
y.create.l HWIO_DIM_D01_DIM_DQ_WR_CDC_STATUS2_ADDR A:0x604810d8
y.create.l HWIO_DIM_D01_DIM_DQ_WR_CDC_STATUS3_ADDR A:0x604810dc
y.create.l HWIO_DIM_D01_DIM_DQ_DQ_IOC_SLV_CFG_ADDR A:0x60481100
y.create.l HWIO_DIM_D01_DIM_DQ_DQ_IOC_SLV_STATUS_ADDR A:0x60481104
y.create.l HWIO_DIM_D01_DIM_DQ_DQS_IOC_SLV_CFG_ADDR A:0x60481110
y.create.l HWIO_DIM_D01_DIM_DQ_DQS_IOC_SLV_STATUS_ADDR A:0x60481114
y.create.l HWIO_DIM_D02_DIM_DQ_TOP_CFG_ADDR A:0x60481800
y.create.l HWIO_DIM_D02_DIM_DQ_HW_INFO_ADDR A:0x60481804
y.create.l HWIO_DIM_D02_DIM_DQ_HW_VERSION_ADDR A:0x60481808
y.create.l HWIO_DIM_D02_DIM_DQ_PAD_CFG0_ADDR A:0x60481810
y.create.l HWIO_DIM_D02_DIM_DQ_PAD_CFG1_ADDR A:0x60481814
y.create.l HWIO_DIM_D02_DIM_DQ_PAD_CFG2_ADDR A:0x60481818
y.create.l HWIO_DIM_D02_DIM_DQ_DQ_SMT_STATUS_ADDR A:0x6048181c
y.create.l HWIO_DIM_D02_DIM_DQ_PAD_CFG3_ADDR A:0x60481820
y.create.l HWIO_DIM_D02_DIM_DQ_PAD_CFG4_ADDR A:0x60481824
y.create.l HWIO_DIM_D02_DDRPHY_DQ_MISR_CFG_ADDR A:0x6048180c
y.create.l HWIO_DIM_D02_DDRPHY_DQ_MISR_EVEN_STATUS_ADDR A:0x60481828
y.create.l HWIO_DIM_D02_DDRPHY_DQ_MISR_ODD_STATUS_ADDR A:0x6048182c
y.create.l HWIO_DIM_D02_DIM_DQ_CDC_CTLR_CFG0_ADDR A:0x60481830
y.create.l HWIO_DIM_D02_DIM_DQ_CDC_CTLR_CFG1_ADDR A:0x60481834
y.create.l HWIO_DIM_D02_DIM_DQ_CDC_CAL_TIMER_CFG0_ADDR A:0x60481838
y.create.l HWIO_DIM_D02_DIM_DQ_CDC_CAL_TIMER_CFG1_ADDR A:0x6048183c
y.create.l HWIO_DIM_D02_DIM_DQ_CDC_REFCOUNT_CFG_ADDR A:0x60481840
y.create.l HWIO_DIM_D02_DIM_DQ_CDC_COARSE_CAL_CFG_ADDR A:0x60481844
y.create.l HWIO_DIM_D02_DIM_DQ_CDC_RSVD_CFG_ADDR A:0x60481848
y.create.l HWIO_DIM_D02_DIM_DQ_RD_CDC_OFFSET_CFG_ADDR A:0x6048184c
y.create.l HWIO_DIM_D02_DIM_DQ_RD_CDC_DELAY_CFG_ADDR A:0x60481850
y.create.l HWIO_DIM_D02_DIM_DQ_RD_CDC_SW_MODE_CFG_ADDR A:0x60481854
y.create.l HWIO_DIM_D02_DIM_DQ_RD_CDC_TEST_CFG_ADDR A:0x60481858
y.create.l HWIO_DIM_D02_DIM_DQ_RD_CDC_SW_OVRD_CFG_ADDR A:0x6048185c
y.create.l HWIO_DIM_D02_DIM_DQ_RD_CDC_SLAVE_DDA_CFG_ADDR A:0x60481860
y.create.l HWIO_DIM_D02_DIM_DQ_RD_CDC_STATUS0_ADDR A:0x60481870
y.create.l HWIO_DIM_D02_DIM_DQ_RD_CDC_STATUS1_ADDR A:0x60481874
y.create.l HWIO_DIM_D02_DIM_DQ_RD_CDC_STATUS2_ADDR A:0x60481878
y.create.l HWIO_DIM_D02_DIM_DQ_RD_CDC_STATUS3_ADDR A:0x6048187c
y.create.l HWIO_DIM_D02_DIM_DQ_RD_CDC_STATUS4_ADDR A:0x60481880
y.create.l HWIO_DIM_D02_DIM_DQ_WR_CDC_OFFSET_CFG_ADDR A:0x604818ac
y.create.l HWIO_DIM_D02_DIM_DQ_WR_CDC_DELAY_CFG_ADDR A:0x604818b0
y.create.l HWIO_DIM_D02_DIM_DQ_WR_CDC_SW_MODE_CFG_ADDR A:0x604818b4
y.create.l HWIO_DIM_D02_DIM_DQ_WR_CDC_TEST_CFG_ADDR A:0x604818b8
y.create.l HWIO_DIM_D02_DIM_DQ_WR_CDC_SW_OVRD_CFG_ADDR A:0x604818bc
y.create.l HWIO_DIM_D02_DIM_DQ_WR_CDC_STATUS0_ADDR A:0x604818d0
y.create.l HWIO_DIM_D02_DIM_DQ_WR_CDC_STATUS1_ADDR A:0x604818d4
y.create.l HWIO_DIM_D02_DIM_DQ_WR_CDC_STATUS2_ADDR A:0x604818d8
y.create.l HWIO_DIM_D02_DIM_DQ_WR_CDC_STATUS3_ADDR A:0x604818dc
y.create.l HWIO_DIM_D02_DIM_DQ_DQ_IOC_SLV_CFG_ADDR A:0x60481900
y.create.l HWIO_DIM_D02_DIM_DQ_DQ_IOC_SLV_STATUS_ADDR A:0x60481904
y.create.l HWIO_DIM_D02_DIM_DQ_DQS_IOC_SLV_CFG_ADDR A:0x60481910
y.create.l HWIO_DIM_D02_DIM_DQ_DQS_IOC_SLV_STATUS_ADDR A:0x60481914
y.create.l HWIO_DIM_D03_DIM_DQ_TOP_CFG_ADDR A:0x60482000
y.create.l HWIO_DIM_D03_DIM_DQ_HW_INFO_ADDR A:0x60482004
y.create.l HWIO_DIM_D03_DIM_DQ_HW_VERSION_ADDR A:0x60482008
y.create.l HWIO_DIM_D03_DIM_DQ_PAD_CFG0_ADDR A:0x60482010
y.create.l HWIO_DIM_D03_DIM_DQ_PAD_CFG1_ADDR A:0x60482014
y.create.l HWIO_DIM_D03_DIM_DQ_PAD_CFG2_ADDR A:0x60482018
y.create.l HWIO_DIM_D03_DIM_DQ_DQ_SMT_STATUS_ADDR A:0x6048201c
y.create.l HWIO_DIM_D03_DIM_DQ_PAD_CFG3_ADDR A:0x60482020
y.create.l HWIO_DIM_D03_DIM_DQ_PAD_CFG4_ADDR A:0x60482024
y.create.l HWIO_DIM_D03_DDRPHY_DQ_MISR_CFG_ADDR A:0x6048200c
y.create.l HWIO_DIM_D03_DDRPHY_DQ_MISR_EVEN_STATUS_ADDR A:0x60482028
y.create.l HWIO_DIM_D03_DDRPHY_DQ_MISR_ODD_STATUS_ADDR A:0x6048202c
y.create.l HWIO_DIM_D03_DIM_DQ_CDC_CTLR_CFG0_ADDR A:0x60482030
y.create.l HWIO_DIM_D03_DIM_DQ_CDC_CTLR_CFG1_ADDR A:0x60482034
y.create.l HWIO_DIM_D03_DIM_DQ_CDC_CAL_TIMER_CFG0_ADDR A:0x60482038
y.create.l HWIO_DIM_D03_DIM_DQ_CDC_CAL_TIMER_CFG1_ADDR A:0x6048203c
y.create.l HWIO_DIM_D03_DIM_DQ_CDC_REFCOUNT_CFG_ADDR A:0x60482040
y.create.l HWIO_DIM_D03_DIM_DQ_CDC_COARSE_CAL_CFG_ADDR A:0x60482044
y.create.l HWIO_DIM_D03_DIM_DQ_CDC_RSVD_CFG_ADDR A:0x60482048
y.create.l HWIO_DIM_D03_DIM_DQ_RD_CDC_OFFSET_CFG_ADDR A:0x6048204c
y.create.l HWIO_DIM_D03_DIM_DQ_RD_CDC_DELAY_CFG_ADDR A:0x60482050
y.create.l HWIO_DIM_D03_DIM_DQ_RD_CDC_SW_MODE_CFG_ADDR A:0x60482054
y.create.l HWIO_DIM_D03_DIM_DQ_RD_CDC_TEST_CFG_ADDR A:0x60482058
y.create.l HWIO_DIM_D03_DIM_DQ_RD_CDC_SW_OVRD_CFG_ADDR A:0x6048205c
y.create.l HWIO_DIM_D03_DIM_DQ_RD_CDC_SLAVE_DDA_CFG_ADDR A:0x60482060
y.create.l HWIO_DIM_D03_DIM_DQ_RD_CDC_STATUS0_ADDR A:0x60482070
y.create.l HWIO_DIM_D03_DIM_DQ_RD_CDC_STATUS1_ADDR A:0x60482074
y.create.l HWIO_DIM_D03_DIM_DQ_RD_CDC_STATUS2_ADDR A:0x60482078
y.create.l HWIO_DIM_D03_DIM_DQ_RD_CDC_STATUS3_ADDR A:0x6048207c
y.create.l HWIO_DIM_D03_DIM_DQ_RD_CDC_STATUS4_ADDR A:0x60482080
y.create.l HWIO_DIM_D03_DIM_DQ_WR_CDC_OFFSET_CFG_ADDR A:0x604820ac
y.create.l HWIO_DIM_D03_DIM_DQ_WR_CDC_DELAY_CFG_ADDR A:0x604820b0
y.create.l HWIO_DIM_D03_DIM_DQ_WR_CDC_SW_MODE_CFG_ADDR A:0x604820b4
y.create.l HWIO_DIM_D03_DIM_DQ_WR_CDC_TEST_CFG_ADDR A:0x604820b8
y.create.l HWIO_DIM_D03_DIM_DQ_WR_CDC_SW_OVRD_CFG_ADDR A:0x604820bc
y.create.l HWIO_DIM_D03_DIM_DQ_WR_CDC_STATUS0_ADDR A:0x604820d0
y.create.l HWIO_DIM_D03_DIM_DQ_WR_CDC_STATUS1_ADDR A:0x604820d4
y.create.l HWIO_DIM_D03_DIM_DQ_WR_CDC_STATUS2_ADDR A:0x604820d8
y.create.l HWIO_DIM_D03_DIM_DQ_WR_CDC_STATUS3_ADDR A:0x604820dc
y.create.l HWIO_DIM_D03_DIM_DQ_DQ_IOC_SLV_CFG_ADDR A:0x60482100
y.create.l HWIO_DIM_D03_DIM_DQ_DQ_IOC_SLV_STATUS_ADDR A:0x60482104
y.create.l HWIO_DIM_D03_DIM_DQ_DQS_IOC_SLV_CFG_ADDR A:0x60482110
y.create.l HWIO_DIM_D03_DIM_DQ_DQS_IOC_SLV_STATUS_ADDR A:0x60482114
y.create.l HWIO_EBI1_HW_VERSION_ADDR A:0x6049f000
y.create.l HWIO_EBI1_HW_INFO_ADDR A:0x6049f004
y.create.l HWIO_EBI1_AHB2PHY_BROADCAST_EN_CFG_LOWER_ADDR A:0x6049f008
y.create.l HWIO_EBI1_AHB2PHY_BROADCAST_EN_CFG_UPPER_ADDR A:0x6049f00c
y.create.l HWIO_EBI1_AHB2PHY_TOP_CFG_ADDR A:0x6049f010
y.create.l HWIO_EBI1_AHB2PHY_DEBUG_BUS_CFG_ADDR A:0x6049f014
y.create.l HWIO_EBI1_AHB2PHY_BROADCAST_ADDRESS_SPACE_0_ADDR A:0x6049f800
y.create.l HWIO_EBI1_AHB2PHY_BROADCAST_ADDRESS_SPACE_1_ADDR A:0x6049f804
y.create.l HWIO_EBI1_AHB2PHY_BROADCAST_ADDRESS_SPACE_2_ADDR A:0x6049f808
y.create.l HWIO_EBI1_AHB2PHY_BROADCAST_ADDRESS_SPACE_3_ADDR A:0x6049f80c
y.create.l HWIO_EBI1_AHB2PHY_BROADCAST_ADDRESS_SPACE_4_ADDR A:0x6049f810
y.create.l HWIO_EBI1_AHB2PHY_BROADCAST_ADDRESS_SPACE_5_ADDR A:0x6049f814
y.create.l HWIO_EBI1_AHB2PHY_BROADCAST_ADDRESS_SPACE_6_ADDR A:0x6049f818
y.create.l HWIO_EBI1_AHB2PHY_BROADCAST_ADDRESS_SPACE_7_ADDR A:0x6049f81c
y.create.l HWIO_EBI1_AHB2PHY_BROADCAST_ADDRESS_SPACE_8_ADDR A:0x6049f820
y.create.l HWIO_EBI1_AHB2PHY_BROADCAST_ADDRESS_SPACE_9_ADDR A:0x6049f824
y.create.l HWIO_MDSS_MDP_SYNC_CONFIG_0_ADDR A:0x61a00300
y.create.l HWIO_MDSS_MDP_SYNC_CONFIG_1_ADDR A:0x61a00304
y.create.l HWIO_MDSS_MDP_SYNC_CONFIG_2_ADDR A:0x61a00308
y.create.l HWIO_MDSS_MDP_SYNC_STATUS_0_ADDR A:0x61a0030c
y.create.l HWIO_MDSS_MDP_SYNC_STATUS_1_ADDR A:0x61a00310
y.create.l HWIO_MDSS_MDP_SYNC_STATUS_2_ADDR A:0x61a00314
y.create.l HWIO_MDSS_MDP_PRIMARY_VSYNC_OUT_CTRL_ADDR A:0x61a00318
y.create.l HWIO_MDSS_MDP_SECONDARY_VSYNC_OUT_CTRL_ADDR A:0x61a0031c
y.create.l HWIO_MDSS_MDP_EXTERNAL_VSYNC_OUT_CTRL_ADDR A:0x61a00320
y.create.l HWIO_MDSS_MDP_VSYNC_SEL_ADDR A:0x61a00324
y.create.l HWIO_MDSS_MDP_PRIM_VSYNC_INIT_VAL_ADDR A:0x61a00328
y.create.l HWIO_MDSS_MDP_SEC_VSYNC_INIT_VAL_ADDR A:0x61a0032c
y.create.l HWIO_MDSS_MDP_EXT_VSYNC_INIT_VAL_ADDR A:0x61a00330
y.create.l HWIO_MDSS_MDP_PRIM_VSYNC_OUT_VAL_ADDR A:0x61a00334
y.create.l HWIO_MDSS_MDP_SEC_VSYNC_OUT_VAL_ADDR A:0x61a00338
y.create.l HWIO_MDSS_MDP_EXT_VSYNC_OUT_VAL_ADDR A:0x61a0033c
y.create.l HWIO_MDSS_MDP_PRIM_INT_CNT_VAL_ADDR A:0x61a00340
y.create.l HWIO_MDSS_MDP_SEC_INT_CNT_VAL_ADDR A:0x61a00344
y.create.l HWIO_MDSS_MDP_EXT_INT_CNT_VAL_ADDR A:0x61a00348
y.create.l HWIO_MDSS_MDP_AUTOREFRESH_CONFIG_P_ADDR A:0x61a0034c
y.create.l HWIO_MDSS_MDP_AUTOREFRESH_CONFIG_S_ADDR A:0x61a00350
y.create.l HWIO_MDSS_MDP_QPIC_EOF_VAL_ADDR A:0x61a00354
y.create.l HWIO_MDSS_MDP_SYNC_THRESH_0_ADDR A:0x61a00200
y.create.l HWIO_MDSS_MDP_SYNC_THRESH_1_ADDR A:0x61a00204
y.create.l HWIO_MDSS_MDP_SYNC_THRESH_2_ADDR A:0x61a00208
y.create.l HWIO_MDSS_MDP_TEAR_CHECK_EN_ADDR A:0x61a0020c
y.create.l HWIO_MDSS_MDP_PRIM_START_POS_ADDR A:0x61a00210
y.create.l HWIO_MDSS_MDP_SEC_START_POS_ADDR A:0x61a00214
y.create.l HWIO_MDSS_MDP_EXT_START_POS_ADDR A:0x61a00218
y.create.l HWIO_MDSS_MDP_PRIMARY_RD_PTR_IRQ_ADDR A:0x61a0021c
y.create.l HWIO_MDSS_MDP_SECONDARY_RD_PTR_IRQ_ADDR A:0x61a00220
y.create.l HWIO_MDSS_MDP_EXTERNAL_RD_PTR_IRQ_ADDR A:0x61a00224
y.create.l HWIO_MDSS_MDP_INTR_ENABLE_ADDR A:0x61a00020
y.create.l HWIO_MDSS_MDP_INTR_STATUS_ADDR A:0x61a00024
y.create.l HWIO_MDSS_MDP_INTR_CLEAR_ADDR A:0x61a00028
y.create.l HWIO_MDSS_MDP_PPP_DL0_START_ADDR A:0x61a00030
y.create.l HWIO_MDSS_MDP_PPP_DL1_START_ADDR A:0x61a00034
y.create.l HWIO_MDSS_MDP_DISPLAY_STATUS_ADDR A:0x61a00038
y.create.l HWIO_MDSS_MDP_DMA_P_START_ADDR A:0x61a00044
y.create.l HWIO_MDSS_MDP_DMA_S_START_ADDR A:0x61a00048
y.create.l HWIO_MDSS_MDP_DMA_E_START_ADDR A:0x61a0004c
y.create.l HWIO_MDSS_MDP_HW_VERSION_ADDR A:0x61a00070
y.create.l HWIO_MDSS_MDP_SW_RESET_ADDR A:0x61a00074
y.create.l HWIO_MDSS_MDP_AXI_RD_ARB_CONFIG_ADDR A:0x61a00078
y.create.l HWIO_MDSS_MDP_SEL_CLK_OR_HCLK_TEST_BUS_ADDR A:0x61a0007c
y.create.l HWIO_MDSS_MDP_EBI2_LCD0_ADDR A:0x61a0003c
y.create.l HWIO_MDSS_MDP_EBI2_LCD1_ADDR A:0x61a00040
y.create.l HWIO_MDSS_MDP_EBI2_LCD0_YSTRIDE_ADDR A:0x61a00050
y.create.l HWIO_MDSS_MDP_EBI2_LCD1_YSTRIDE_ADDR A:0x61a00054
y.create.l HWIO_MDSS_MDP_EBI2_PORTMAP_MODE_ADDR A:0x61a0005c
y.create.l HWIO_MDSS_MDP_HALT_REQ_ACK_ADDR A:0x61a00060
y.create.l HWIO_MDSS_MDP_MDDI_PARAM_WR_SEL_ADDR A:0x61a00090
y.create.l HWIO_MDSS_MDP_MDDI_PARAM_ADDR A:0x61a00094
y.create.l HWIO_MDSS_MDP_CGC_EN_ADDR A:0x61a00100
y.create.l HWIO_MDSS_DEBUGBUS_VBIF_ATB_ADDR A:0x61a00104
y.create.l HWIO_MDSS_MDP_PPP_DL0_ADDR_ADDR A:0x61a10000
y.create.l HWIO_MDSS_MDP_PPP_DL1_ADDR_ADDR A:0x61a10004
y.create.l HWIO_MDSS_MDP_PPP_CMD_STATUS_ADDR A:0x61a10008
y.create.l HWIO_MDSS_MDP_PPP_PROFILE_EN_ADDR A:0x61a10010
y.create.l HWIO_MDSS_MDP_PPP_PROFILE_COUNT_ADDR A:0x61a10014
y.create.l HWIO_MDSS_MDP_PPP_CMD_MODE_ADDR A:0x61a10060
y.create.l HWIO_MDSS_MDP_PPP_SRC_SIZE_ADDR A:0x61a10108
y.create.l HWIO_MDSS_MDP_PPP_SRCP0_ADDR_ADDR A:0x61a1010c
y.create.l HWIO_MDSS_MDP_PPP_SRCP1_ADDR_ADDR A:0x61a10110
y.create.l HWIO_MDSS_MDP_PPP_SRCP3_ADDR_ADDR A:0x61a10118
y.create.l HWIO_MDSS_MDP_PPP_SRC_YSTRIDE1_ADDR A:0x61a1011c
y.create.l HWIO_MDSS_MDP_PPP_SRC_YSTRIDE2_ADDR A:0x61a10120
y.create.l HWIO_MDSS_MDP_PPP_SRC_FORMAT_ADDR A:0x61a10124
y.create.l HWIO_MDSS_MDP_PPP_SRC_UNPACK_PATTERN1_ADDR A:0x61a10128
y.create.l HWIO_MDSS_MDP_PPP_SRC_UNPACK_PATTERN2_ADDR A:0x61a1012c
y.create.l HWIO_MDSS_MDP_PPP_OP_MODE_ADDR A:0x61a10138
y.create.l HWIO_MDSS_MDP_PPP_SCALE_PHASEX_INIT_ADDR A:0x61a1013c
y.create.l HWIO_MDSS_MDP_PPP_SCALE_PHASEY_INIT_ADDR A:0x61a10140
y.create.l HWIO_MDSS_MDP_PPP_SCALE_PHASEX_STEP_ADDR A:0x61a10144
y.create.l HWIO_MDSS_MDP_PPP_SCALE_PHASEY_STEP_ADDR A:0x61a10148
y.create.l HWIO_MDSS_MDP_PPP_BLEND_PARAM_ADDR A:0x61a1014c
y.create.l HWIO_MDSS_MDP_PPP_OUT_FORMAT_ADDR A:0x61a10150
y.create.l HWIO_MDSS_MDP_PPP_OUT_PACK_PATTERN1_ADDR A:0x61a10154
y.create.l HWIO_MDSS_MDP_PPP_OUT_PACK_PATTERN2_ADDR A:0x61a10158
y.create.l HWIO_MDSS_MDP_PPP_OUT_SIZE_ADDR A:0x61a10164
y.create.l HWIO_MDSS_MDP_PPP_OUTP0_ADDR_ADDR A:0x61a10168
y.create.l HWIO_MDSS_MDP_PPP_OUTP1_ADDR_ADDR A:0x61a1016c
y.create.l HWIO_MDSS_MDP_PPP_OUTP3_ADDR_ADDR A:0x61a10174
y.create.l HWIO_MDSS_MDP_PPP_OUT_YSTRIDE1_ADDR A:0x61a10178
y.create.l HWIO_MDSS_MDP_PPP_OUT_YSTRIDE2_ADDR A:0x61a1017c
y.create.l HWIO_MDSS_MDP_PPP_OUT_XY_ADDR A:0x61a1019c
y.create.l HWIO_MDSS_MDP_PPP_SRC_EDGE_REP_ADDR A:0x61a101b8
y.create.l HWIO_MDSS_MDP_PPP_BG_EDGE_REP_ADDR A:0x61a101bc
y.create.l HWIO_MDSS_MDP_PPP_BGP0_ADDR_ADDR A:0x61a101c0
y.create.l HWIO_MDSS_MDP_PPP_BGP1_ADDR_ADDR A:0x61a101c4
y.create.l HWIO_MDSS_MDP_PPP_BGP3_ADDR_ADDR A:0x61a101c8
y.create.l HWIO_MDSS_MDP_PPP_BG_YSTRIDE1_ADDR A:0x61a101cc
y.create.l HWIO_MDSS_MDP_PPP_BG_YSTRIDE2_ADDR A:0x61a101d0
y.create.l HWIO_MDSS_MDP_PPP_BG_FORMAT_ADDR A:0x61a101d4
y.create.l HWIO_MDSS_MDP_PPP_BG_UNPACK_PATTERN1_ADDR A:0x61a101d8
y.create.l HWIO_MDSS_MDP_PPP_BG_UNPACK_PATTERN2_ADDR A:0x61a101dc
y.create.l HWIO_MDSS_MDP_PPP_TFETCH_TEST_MODE_ADDR A:0x61a20004
y.create.l HWIO_MDSS_MDP_PPP_TFETCH_STATUS_ADDR A:0x61a20008
y.create.l HWIO_MDSS_MDP_PPP_TFETCH_TILE_COUNT_ADDR A:0x61a20010
y.create.l HWIO_MDSS_MDP_PPP_TFETCH_FETCH_COUNT_ADDR A:0x61a20014
y.create.l HWIO_MDSS_MDP_PPP_TFETCH_CONSTANT_COLOR_ADDR A:0x61a20040
y.create.l HWIO_MDSS_MDP_PPP_PRIORITY_QOS_REMAPPER_ADDR A:0x61a21000
y.create.l HWIO_MDSS_MDP_PPP_PRIORITYLVL_QOS_REMAPPER_ADDR A:0x61a21004
y.create.l HWIO_MDSS_MDP_PPP_CSC_BYPASS_ADDR A:0x61a40004
y.create.l HWIO_MDSS_MDP_PPP_CSC_PFMV0_ADDR A:0x61a40400
y.create.l HWIO_MDSS_MDP_PPP_CSC_PFMV1_ADDR A:0x61a40404
y.create.l HWIO_MDSS_MDP_PPP_CSC_PFMV2_ADDR A:0x61a40408
y.create.l HWIO_MDSS_MDP_PPP_CSC_PFMV3_ADDR A:0x61a4040c
y.create.l HWIO_MDSS_MDP_PPP_CSC_PFMV4_ADDR A:0x61a40410
y.create.l HWIO_MDSS_MDP_PPP_CSC_PFMV5_ADDR A:0x61a40414
y.create.l HWIO_MDSS_MDP_PPP_CSC_PFMV6_ADDR A:0x61a40418
y.create.l HWIO_MDSS_MDP_PPP_CSC_PFMV7_ADDR A:0x61a4041c
y.create.l HWIO_MDSS_MDP_PPP_CSC_PFMV8_ADDR A:0x61a40420
y.create.l HWIO_MDSS_MDP_PPP_CSC_PRMV0_ADDR A:0x61a40440
y.create.l HWIO_MDSS_MDP_PPP_CSC_PRMV1_ADDR A:0x61a40444
y.create.l HWIO_MDSS_MDP_PPP_CSC_PRMV2_ADDR A:0x61a40448
y.create.l HWIO_MDSS_MDP_PPP_CSC_PRMV3_ADDR A:0x61a4044c
y.create.l HWIO_MDSS_MDP_PPP_CSC_PRMV4_ADDR A:0x61a40450
y.create.l HWIO_MDSS_MDP_PPP_CSC_PRMV5_ADDR A:0x61a40454
y.create.l HWIO_MDSS_MDP_PPP_CSC_PRMV6_ADDR A:0x61a40458
y.create.l HWIO_MDSS_MDP_PPP_CSC_PRMV7_ADDR A:0x61a4045c
y.create.l HWIO_MDSS_MDP_PPP_CSC_PRMV8_ADDR A:0x61a40460
y.create.l HWIO_MDSS_MDP_PPP_CSC_SFMV0_ADDR A:0x61a40480
y.create.l HWIO_MDSS_MDP_PPP_CSC_SFMV1_ADDR A:0x61a40484
y.create.l HWIO_MDSS_MDP_PPP_CSC_SFMV2_ADDR A:0x61a40488
y.create.l HWIO_MDSS_MDP_PPP_CSC_SFMV3_ADDR A:0x61a4048c
y.create.l HWIO_MDSS_MDP_PPP_CSC_SFMV4_ADDR A:0x61a40490
y.create.l HWIO_MDSS_MDP_PPP_CSC_SFMV5_ADDR A:0x61a40494
y.create.l HWIO_MDSS_MDP_PPP_CSC_SFMV6_ADDR A:0x61a40498
y.create.l HWIO_MDSS_MDP_PPP_CSC_SFMV7_ADDR A:0x61a4049c
y.create.l HWIO_MDSS_MDP_PPP_CSC_SFMV8_ADDR A:0x61a404a0
y.create.l HWIO_MDSS_MDP_PPP_CSC_SRMV0_ADDR A:0x61a404c0
y.create.l HWIO_MDSS_MDP_PPP_CSC_SRMV1_ADDR A:0x61a404c4
y.create.l HWIO_MDSS_MDP_PPP_CSC_SRMV2_ADDR A:0x61a404c8
y.create.l HWIO_MDSS_MDP_PPP_CSC_SRMV3_ADDR A:0x61a404cc
y.create.l HWIO_MDSS_MDP_PPP_CSC_SRMV4_ADDR A:0x61a404d0
y.create.l HWIO_MDSS_MDP_PPP_CSC_SRMV5_ADDR A:0x61a404d4
y.create.l HWIO_MDSS_MDP_PPP_CSC_SRMV6_ADDR A:0x61a404d8
y.create.l HWIO_MDSS_MDP_PPP_CSC_SRMV7_ADDR A:0x61a404dc
y.create.l HWIO_MDSS_MDP_PPP_CSC_SRMV8_ADDR A:0x61a404e0
y.create.l HWIO_MDSS_MDP_PPP_CSC_PBV0_ADDR A:0x61a40500
y.create.l HWIO_MDSS_MDP_PPP_CSC_PBV1_ADDR A:0x61a40504
y.create.l HWIO_MDSS_MDP_PPP_CSC_PBV2_ADDR A:0x61a40508
y.create.l HWIO_MDSS_MDP_PPP_CSC_SBV0_ADDR A:0x61a40540
y.create.l HWIO_MDSS_MDP_PPP_CSC_SBV1_ADDR A:0x61a40544
y.create.l HWIO_MDSS_MDP_PPP_CSC_SBV2_ADDR A:0x61a40548
y.create.l HWIO_MDSS_MDP_PPP_CSC_PLV0_ADDR A:0x61a40580
y.create.l HWIO_MDSS_MDP_PPP_CSC_PLV1_ADDR A:0x61a40584
y.create.l HWIO_MDSS_MDP_PPP_CSC_PLV2_ADDR A:0x61a40588
y.create.l HWIO_MDSS_MDP_PPP_CSC_PLV3_ADDR A:0x61a4058c
y.create.l HWIO_MDSS_MDP_PPP_CSC_SLV0_ADDR A:0x61a405c0
y.create.l HWIO_MDSS_MDP_PPP_CSC_SLV1_ADDR A:0x61a405c4
y.create.l HWIO_MDSS_MDP_PPP_CSC_SLV2_ADDR A:0x61a405c8
y.create.l HWIO_MDSS_MDP_PPP_CSC_SLV3_ADDR A:0x61a405cc
y.create.l HWIO_MDSS_MDP_PPP_CSC_PRELT0_ADDR A:0x61a40800
y.create.l HWIO_MDSS_MDP_PPP_CSC_PRELT1_ADDR A:0x61a40804
y.create.l HWIO_MDSS_MDP_PPP_CSC_PRELT2_ADDR A:0x61a40808
y.create.l HWIO_MDSS_MDP_PPP_CSC_PRELT3_ADDR A:0x61a4080c
y.create.l HWIO_MDSS_MDP_PPP_CSC_PRELT4_ADDR A:0x61a40810
y.create.l HWIO_MDSS_MDP_PPP_CSC_PRELT5_ADDR A:0x61a40814
y.create.l HWIO_MDSS_MDP_PPP_CSC_PRELT6_ADDR A:0x61a40818
y.create.l HWIO_MDSS_MDP_PPP_CSC_PRELT7_ADDR A:0x61a4081c
y.create.l HWIO_MDSS_MDP_PPP_CSC_PRELT8_ADDR A:0x61a40820
y.create.l HWIO_MDSS_MDP_PPP_CSC_PRELT9_ADDR A:0x61a40824
y.create.l HWIO_MDSS_MDP_PPP_CSC_POSTLT0_ADDR A:0x61a40c00
y.create.l HWIO_MDSS_MDP_PPP_CSC_POSTLT1_ADDR A:0x61a40c04
y.create.l HWIO_MDSS_MDP_PPP_CSC_POSTLT2_ADDR A:0x61a40c08
y.create.l HWIO_MDSS_MDP_PPP_CSC_POSTLT3_ADDR A:0x61a40c0c
y.create.l HWIO_MDSS_MDP_PPP_CSC_POSTLT4_ADDR A:0x61a40c10
y.create.l HWIO_MDSS_MDP_PPP_CSC_POSTLT5_ADDR A:0x61a40c14
y.create.l HWIO_MDSS_MDP_PPP_CSC_POSTLT6_ADDR A:0x61a40c18
y.create.l HWIO_MDSS_MDP_PPP_CSC_POSTLT7_ADDR A:0x61a40c1c
y.create.l HWIO_MDSS_MDP_PPP_CSC_POSTLT8_ADDR A:0x61a40c20
y.create.l HWIO_MDSS_MDP_PPP_CSC_POSTLT9_ADDR A:0x61a40c24
y.create.l HWIO_MDSS_MDP_PPP_SCALE_COEFF_MSB0_ADDR A:0x61a50200
y.create.l HWIO_MDSS_MDP_PPP_SCALE_COEFF_MSB1_ADDR A:0x61a50204
y.create.l HWIO_MDSS_MDP_PPP_SCALE_COEFF_MSB2_ADDR A:0x61a50208
y.create.l HWIO_MDSS_MDP_PPP_SCALE_COEFF_MSB3_ADDR A:0x61a5020c
y.create.l HWIO_MDSS_MDP_PPP_SCALE_COEFF_MSB4_ADDR A:0x61a50210
y.create.l HWIO_MDSS_MDP_PPP_SCALE_COEFF_MSB5_ADDR A:0x61a50214
y.create.l HWIO_MDSS_MDP_PPP_SCALE_COEFF_MSB6_ADDR A:0x61a50218
y.create.l HWIO_MDSS_MDP_PPP_SCALE_COEFF_MSB7_ADDR A:0x61a5021c
y.create.l HWIO_MDSS_MDP_PPP_SCALE_COEFF_MSB8_ADDR A:0x61a50220
y.create.l HWIO_MDSS_MDP_PPP_SCALE_COEFF_MSB9_ADDR A:0x61a50224
y.create.l HWIO_MDSS_MDP_PPP_SCALE_COEFF_LSB_ADDR A:0x61a5fffc
y.create.l HWIO_MDSS_MDP_PPP_BLEND_COLOR3_OUT_ADDR A:0x61a70004
y.create.l HWIO_MDSS_MDP_PPP_BLEND_BG_ALPHA_SEL_ADDR A:0x61a70010
y.create.l HWIO_MDSS_MDP_DMA_P_CONFIG_ADDR A:0x61a90000
y.create.l HWIO_MDSS_MDP_DMA_P_SIZE_ADDR A:0x61a90004
y.create.l HWIO_MDSS_MDP_DMA_P_IBUF_ADDR_ADDR A:0x61a90008
y.create.l HWIO_MDSS_MDP_DMA_P_IBUF_Y_STRIDE_ADDR A:0x61a9000c
y.create.l HWIO_MDSS_MDP_DMA_P_OUT_XY_ADDR A:0x61a90010
y.create.l HWIO_MDSS_MDP_DMA_P_LINE_COUNT_ADDR A:0x61a90014
y.create.l HWIO_MDSS_MDP_DMA_P_LINE_IRQ_ADDR A:0x61a90018
y.create.l HWIO_MDSS_MDP_DMA_P_MASK_PATTERN_ADDR A:0x61a9001c
y.create.l HWIO_MDSS_MDP_DMA_P_PROFILE_EN_ADDR A:0x61a90020
y.create.l HWIO_MDSS_MDP_DMA_P_PROFILE_COUNT_ADDR A:0x61a90024
y.create.l HWIO_MDSS_MDP_DMA_P_CURSOR_FORMAT_ADDR A:0x61a90040
y.create.l HWIO_MDSS_MDP_DMA_P_CURSOR_SIZE_ADDR A:0x61a90044
y.create.l HWIO_MDSS_MDP_DMA_P_CURSOR_BUF_ADDR_ADDR A:0x61a90048
y.create.l HWIO_MDSS_MDP_DMA_P_CURSOR_POSITION_ADDR A:0x61a9004c
y.create.l HWIO_MDSS_MDP_DMA_P_CURSOR_BLEND_CONFIG_ADDR A:0x61a90060
y.create.l HWIO_MDSS_MDP_DMA_P_CURSOR_BLEND_PARAM_ADDR A:0x61a90064
y.create.l HWIO_MDSS_MDP_DMA_P_CURSOR_BLEND_TRANS_MASK_ADDR A:0x61a90068
y.create.l HWIO_MDSS_MDP_DMA_P_COLOR_CORRECT_CONFIG_ADDR A:0x61a90070
y.create.l HWIO_MDSS_MDP_DMA_P_CSC_BYPASS_ADDR A:0x61a93004
y.create.l HWIO_MDSS_MDP_DMA_P_CSC_MV10_ADDR A:0x61a93400
y.create.l HWIO_MDSS_MDP_DMA_P_CSC_MV11_ADDR A:0x61a93404
y.create.l HWIO_MDSS_MDP_DMA_P_CSC_MV12_ADDR A:0x61a93408
y.create.l HWIO_MDSS_MDP_DMA_P_CSC_MV13_ADDR A:0x61a9340c
y.create.l HWIO_MDSS_MDP_DMA_P_CSC_MV14_ADDR A:0x61a93410
y.create.l HWIO_MDSS_MDP_DMA_P_CSC_MV15_ADDR A:0x61a93414
y.create.l HWIO_MDSS_MDP_DMA_P_CSC_MV16_ADDR A:0x61a93418
y.create.l HWIO_MDSS_MDP_DMA_P_CSC_MV17_ADDR A:0x61a9341c
y.create.l HWIO_MDSS_MDP_DMA_P_CSC_MV18_ADDR A:0x61a93420
y.create.l HWIO_MDSS_MDP_DMA_P_CSC_MV20_ADDR A:0x61a93440
y.create.l HWIO_MDSS_MDP_DMA_P_CSC_MV21_ADDR A:0x61a93444
y.create.l HWIO_MDSS_MDP_DMA_P_CSC_MV22_ADDR A:0x61a93448
y.create.l HWIO_MDSS_MDP_DMA_P_CSC_MV23_ADDR A:0x61a9344c
y.create.l HWIO_MDSS_MDP_DMA_P_CSC_MV24_ADDR A:0x61a93450
y.create.l HWIO_MDSS_MDP_DMA_P_CSC_MV25_ADDR A:0x61a93454
y.create.l HWIO_MDSS_MDP_DMA_P_CSC_MV26_ADDR A:0x61a93458
y.create.l HWIO_MDSS_MDP_DMA_P_CSC_MV27_ADDR A:0x61a9345c
y.create.l HWIO_MDSS_MDP_DMA_P_CSC_MV28_ADDR A:0x61a93460
y.create.l HWIO_MDSS_MDP_DMA_P_CSC_PRE_BV10_ADDR A:0x61a93500
y.create.l HWIO_MDSS_MDP_DMA_P_CSC_PRE_BV11_ADDR A:0x61a93504
y.create.l HWIO_MDSS_MDP_DMA_P_CSC_PRE_BV12_ADDR A:0x61a93508
y.create.l HWIO_MDSS_MDP_DMA_P_CSC_PRE_BV20_ADDR A:0x61a93540
y.create.l HWIO_MDSS_MDP_DMA_P_CSC_PRE_BV21_ADDR A:0x61a93544
y.create.l HWIO_MDSS_MDP_DMA_P_CSC_PRE_BV22_ADDR A:0x61a93548
y.create.l HWIO_MDSS_MDP_DMA_P_CSC_POST_BV10_ADDR A:0x61a93580
y.create.l HWIO_MDSS_MDP_DMA_P_CSC_POST_BV11_ADDR A:0x61a93584
y.create.l HWIO_MDSS_MDP_DMA_P_CSC_POST_BV12_ADDR A:0x61a93588
y.create.l HWIO_MDSS_MDP_DMA_P_CSC_POST_BV20_ADDR A:0x61a935c0
y.create.l HWIO_MDSS_MDP_DMA_P_CSC_POST_BV21_ADDR A:0x61a935c4
y.create.l HWIO_MDSS_MDP_DMA_P_CSC_POST_BV22_ADDR A:0x61a935c8
y.create.l HWIO_MDSS_MDP_DMA_P_CSC_PRE_LV10_ADDR A:0x61a93600
y.create.l HWIO_MDSS_MDP_DMA_P_CSC_PRE_LV11_ADDR A:0x61a93604
y.create.l HWIO_MDSS_MDP_DMA_P_CSC_PRE_LV12_ADDR A:0x61a93608
y.create.l HWIO_MDSS_MDP_DMA_P_CSC_PRE_LV13_ADDR A:0x61a9360c
y.create.l HWIO_MDSS_MDP_DMA_P_CSC_PRE_LV14_ADDR A:0x61a93610
y.create.l HWIO_MDSS_MDP_DMA_P_CSC_PRE_LV15_ADDR A:0x61a93614
y.create.l HWIO_MDSS_MDP_DMA_P_CSC_PRE_LV20_ADDR A:0x61a93640
y.create.l HWIO_MDSS_MDP_DMA_P_CSC_PRE_LV21_ADDR A:0x61a93644
y.create.l HWIO_MDSS_MDP_DMA_P_CSC_PRE_LV22_ADDR A:0x61a93648
y.create.l HWIO_MDSS_MDP_DMA_P_CSC_PRE_LV23_ADDR A:0x61a9364c
y.create.l HWIO_MDSS_MDP_DMA_P_CSC_PRE_LV24_ADDR A:0x61a93650
y.create.l HWIO_MDSS_MDP_DMA_P_CSC_PRE_LV25_ADDR A:0x61a93654
y.create.l HWIO_MDSS_MDP_DMA_P_CSC_POST_LV10_ADDR A:0x61a93680
y.create.l HWIO_MDSS_MDP_DMA_P_CSC_POST_LV11_ADDR A:0x61a93684
y.create.l HWIO_MDSS_MDP_DMA_P_CSC_POST_LV12_ADDR A:0x61a93688
y.create.l HWIO_MDSS_MDP_DMA_P_CSC_POST_LV13_ADDR A:0x61a9368c
y.create.l HWIO_MDSS_MDP_DMA_P_CSC_POST_LV14_ADDR A:0x61a93690
y.create.l HWIO_MDSS_MDP_DMA_P_CSC_POST_LV15_ADDR A:0x61a93694
y.create.l HWIO_MDSS_MDP_DMA_P_CSC_POST_LV20_ADDR A:0x61a936c0
y.create.l HWIO_MDSS_MDP_DMA_P_CSC_POST_LV21_ADDR A:0x61a936c4
y.create.l HWIO_MDSS_MDP_DMA_P_CSC_POST_LV22_ADDR A:0x61a936c8
y.create.l HWIO_MDSS_MDP_DMA_P_CSC_POST_LV23_ADDR A:0x61a936cc
y.create.l HWIO_MDSS_MDP_DMA_P_CSC_POST_LV24_ADDR A:0x61a936d0
y.create.l HWIO_MDSS_MDP_DMA_P_CSC_POST_LV25_ADDR A:0x61a936d4
y.create.l HWIO_MDSS_MDP_DMA_P_CSC_LUT10_ADDR A:0x61a93800
y.create.l HWIO_MDSS_MDP_DMA_P_CSC_LUT11_ADDR A:0x61a93804
y.create.l HWIO_MDSS_MDP_DMA_P_CSC_LUT12_ADDR A:0x61a93808
y.create.l HWIO_MDSS_MDP_DMA_P_CSC_LUT13_ADDR A:0x61a9380c
y.create.l HWIO_MDSS_MDP_DMA_P_CSC_LUT14_ADDR A:0x61a93810
y.create.l HWIO_MDSS_MDP_DMA_P_CSC_LUT15_ADDR A:0x61a93814
y.create.l HWIO_MDSS_MDP_DMA_P_CSC_LUT16_ADDR A:0x61a93818
y.create.l HWIO_MDSS_MDP_DMA_P_CSC_LUT17_ADDR A:0x61a9381c
y.create.l HWIO_MDSS_MDP_DMA_P_CSC_LUT18_ADDR A:0x61a93820
y.create.l HWIO_MDSS_MDP_DMA_P_CSC_LUT19_ADDR A:0x61a93824
y.create.l HWIO_MDSS_MDP_DMA_P_CSC_LUT20_ADDR A:0x61a93c00
y.create.l HWIO_MDSS_MDP_DMA_P_CSC_LUT21_ADDR A:0x61a93c04
y.create.l HWIO_MDSS_MDP_DMA_P_CSC_LUT22_ADDR A:0x61a93c08
y.create.l HWIO_MDSS_MDP_DMA_P_CSC_LUT23_ADDR A:0x61a93c0c
y.create.l HWIO_MDSS_MDP_DMA_P_CSC_LUT24_ADDR A:0x61a93c10
y.create.l HWIO_MDSS_MDP_DMA_P_CSC_LUT25_ADDR A:0x61a93c14
y.create.l HWIO_MDSS_MDP_DMA_P_CSC_LUT26_ADDR A:0x61a93c18
y.create.l HWIO_MDSS_MDP_DMA_P_CSC_LUT27_ADDR A:0x61a93c1c
y.create.l HWIO_MDSS_MDP_DMA_P_CSC_LUT28_ADDR A:0x61a93c20
y.create.l HWIO_MDSS_MDP_DMA_P_CSC_LUT29_ADDR A:0x61a93c24
y.create.l HWIO_MDSS_MDP_DMA_P_HIST_START_ADDR A:0x61a94000
y.create.l HWIO_MDSS_MDP_DMA_P_HIST_FRAME_CNT_ADDR A:0x61a94004
y.create.l HWIO_MDSS_MDP_DMA_P_HIST_BIT_MASK_ADDR A:0x61a94008
y.create.l HWIO_MDSS_MDP_DMA_P_HIST_RESET_SEQ_START_ADDR A:0x61a9400c
y.create.l HWIO_MDSS_MDP_DMA_P_HIST_CONTROL_ADDR A:0x61a94010
y.create.l HWIO_MDSS_MDP_DMA_P_HIST_INTR_STATUS_ADDR A:0x61a94014
y.create.l HWIO_MDSS_MDP_DMA_P_HIST_INTR_CLEAR_ADDR A:0x61a94018
y.create.l HWIO_MDSS_MDP_DMA_P_HIST_INTR_ENABLE_ADDR A:0x61a9401c
y.create.l HWIO_MDSS_MDP_DMA_P_HIST_STOP_REQ_ADDR A:0x61a94020
y.create.l HWIO_MDSS_MDP_DMA_P_HIST_CANCEL_REQ_ADDR A:0x61a94024
y.create.l HWIO_MDSS_MDP_DMA_P_HIST_EXTRA_INFO_0_ADDR A:0x61a94028
y.create.l HWIO_MDSS_MDP_DMA_P_HIST_EXTRA_INFO_1_ADDR A:0x61a9402c
y.create.l HWIO_MDSS_MDP_DMA_P_HIST_R_DATA0_ADDR A:0x61a94100
y.create.l HWIO_MDSS_MDP_DMA_P_HIST_R_DATA1_ADDR A:0x61a94104
y.create.l HWIO_MDSS_MDP_DMA_P_HIST_R_DATA2_ADDR A:0x61a94108
y.create.l HWIO_MDSS_MDP_DMA_P_HIST_R_DATA3_ADDR A:0x61a9410c
y.create.l HWIO_MDSS_MDP_DMA_P_HIST_R_DATA4_ADDR A:0x61a94110
y.create.l HWIO_MDSS_MDP_DMA_P_HIST_R_DATA5_ADDR A:0x61a94114
y.create.l HWIO_MDSS_MDP_DMA_P_HIST_R_DATA6_ADDR A:0x61a94118
y.create.l HWIO_MDSS_MDP_DMA_P_HIST_R_DATA7_ADDR A:0x61a9411c
y.create.l HWIO_MDSS_MDP_DMA_P_HIST_R_DATA8_ADDR A:0x61a94120
y.create.l HWIO_MDSS_MDP_DMA_P_HIST_R_DATA9_ADDR A:0x61a94124
y.create.l HWIO_MDSS_MDP_DMA_P_HIST_G_DATA0_ADDR A:0x61a94200
y.create.l HWIO_MDSS_MDP_DMA_P_HIST_G_DATA1_ADDR A:0x61a94204
y.create.l HWIO_MDSS_MDP_DMA_P_HIST_G_DATA2_ADDR A:0x61a94208
y.create.l HWIO_MDSS_MDP_DMA_P_HIST_G_DATA3_ADDR A:0x61a9420c
y.create.l HWIO_MDSS_MDP_DMA_P_HIST_G_DATA4_ADDR A:0x61a94210
y.create.l HWIO_MDSS_MDP_DMA_P_HIST_G_DATA5_ADDR A:0x61a94214
y.create.l HWIO_MDSS_MDP_DMA_P_HIST_G_DATA6_ADDR A:0x61a94218
y.create.l HWIO_MDSS_MDP_DMA_P_HIST_G_DATA7_ADDR A:0x61a9421c
y.create.l HWIO_MDSS_MDP_DMA_P_HIST_G_DATA8_ADDR A:0x61a94220
y.create.l HWIO_MDSS_MDP_DMA_P_HIST_G_DATA9_ADDR A:0x61a94224
y.create.l HWIO_MDSS_MDP_DMA_P_HIST_B_DATA0_ADDR A:0x61a94300
y.create.l HWIO_MDSS_MDP_DMA_P_HIST_B_DATA1_ADDR A:0x61a94304
y.create.l HWIO_MDSS_MDP_DMA_P_HIST_B_DATA2_ADDR A:0x61a94308
y.create.l HWIO_MDSS_MDP_DMA_P_HIST_B_DATA3_ADDR A:0x61a9430c
y.create.l HWIO_MDSS_MDP_DMA_P_HIST_B_DATA4_ADDR A:0x61a94310
y.create.l HWIO_MDSS_MDP_DMA_P_HIST_B_DATA5_ADDR A:0x61a94314
y.create.l HWIO_MDSS_MDP_DMA_P_HIST_B_DATA6_ADDR A:0x61a94318
y.create.l HWIO_MDSS_MDP_DMA_P_HIST_B_DATA7_ADDR A:0x61a9431c
y.create.l HWIO_MDSS_MDP_DMA_P_HIST_B_DATA8_ADDR A:0x61a94320
y.create.l HWIO_MDSS_MDP_DMA_P_HIST_B_DATA9_ADDR A:0x61a94324
y.create.l HWIO_MDSS_MDP_DMA_P_FETCH_CFG_ADDR A:0x61a90074
y.create.l HWIO_MDSS_MDP_DMA_P_PKR_ADDR_ADDR A:0x61a90078
y.create.l HWIO_MDSS_MDP_DMA_P_DCVS_CTRL_ADDR A:0x61a90080
y.create.l HWIO_MDSS_MDP_DMA_P_DCVS_STATUS_ADDR A:0x61a90084
y.create.l HWIO_MDSS_MDP_DMA_P_QOS_REMAPPER_ADDR A:0x61a90090
y.create.l HWIO_MDSS_MDP_DMA_P_WATERMARK_0_ADDR A:0x61a90094
y.create.l HWIO_MDSS_MDP_DMA_P_WATERMARK_1_ADDR A:0x61a90098
y.create.l HWIO_MDSS_MDP_DMA_P_WATERMARK_2_ADDR A:0x61a9009c
y.create.l HWIO_MDSS_MDP_PANIC_ROBUST_CTRL_ADDR A:0x61a900a0
y.create.l HWIO_MDSS_MDP_PANIC_LUT0_ADDR A:0x61a900a4
y.create.l HWIO_MDSS_MDP_PANIC_LUT1_ADDR A:0x61a900a8
y.create.l HWIO_MDSS_MDP_ROBUST_LUT_ADDR A:0x61a900ac
y.create.l HWIO_MDSS_MDP_DMA_S_CONFIG_ADDR A:0x61aa0000
y.create.l HWIO_MDSS_MDP_DMA_S_SIZE_ADDR A:0x61aa0004
y.create.l HWIO_MDSS_MDP_DMA_S_IBUF_ADDR_ADDR A:0x61aa0008
y.create.l HWIO_MDSS_MDP_DMA_S_IBUF_Y_STRIDE_ADDR A:0x61aa000c
y.create.l HWIO_MDSS_MDP_DMA_S_OUT_XY_ADDR A:0x61aa0010
y.create.l HWIO_MDSS_MDP_DMA_S_LINE_COUNT_ADDR A:0x61aa0014
y.create.l HWIO_MDSS_MDP_DMA_S_LINE_IRQ_ADDR A:0x61aa0018
y.create.l HWIO_MDSS_MDP_DMA_S_MASK_PATTERN_ADDR A:0x61aa001c
y.create.l HWIO_MDSS_MDP_DMA_S_PROFILE_EN_ADDR A:0x61aa0020
y.create.l HWIO_MDSS_MDP_DMA_S_PROFILE_COUNT_ADDR A:0x61aa0024
y.create.l HWIO_MDSS_MDP_TEST_MODE_CLK_ADDR A:0x61ad0000
y.create.l HWIO_MDSS_MDP_TEST_MISR_RESET_CLK_ADDR A:0x61ad0004
y.create.l HWIO_MDSS_MDP_TEST_EXPORT_MISR_CLK_ADDR A:0x61ad0008
y.create.l HWIO_MDSS_MDP_TEST_MISR_CURR_VAL_CLK_ADDR A:0x61ad000c
y.create.l HWIO_MDSS_MDP_TEST_MODE_HCLK_ADDR A:0x61ad0100
y.create.l HWIO_MDSS_MDP_TEST_MISR_RESET_HCLK_ADDR A:0x61ad0104
y.create.l HWIO_MDSS_MDP_TEST_EXPORT_MISR_HCLK_ADDR A:0x61ad0108
y.create.l HWIO_MDSS_MDP_TEST_MISR_CURR_VAL_HCLK_ADDR A:0x61ad010c
y.create.l HWIO_MDSS_MDP_TEST_MODE_DCLK_ADDR A:0x61ad0200
y.create.l HWIO_MDSS_MDP_TEST_MISR_RESET_DCLK_ADDR A:0x61ad0204
y.create.l HWIO_MDSS_MDP_TEST_EXPORT_MISR_DCLK_ADDR A:0x61ad0208
y.create.l HWIO_MDSS_MDP_TEST_MISR_CURR_VAL_DCLK_ADDR A:0x61ad020c
y.create.l HWIO_MDSS_MDP_TEST_CAPTURED_DCLK_ADDR A:0x61ad0210
y.create.l HWIO_MDSS_MDP_TEST_MISR_CAPT_VAL_DCLK_ADDR A:0x61ad0214
y.create.l HWIO_MDSS_MDP_TEST_MODE_TVCLK_ADDR A:0x61ad0300
y.create.l HWIO_MDSS_MDP_TEST_MISR_RESET_TVCLK_ADDR A:0x61ad0304
y.create.l HWIO_MDSS_MDP_TEST_EXPORT_MISR_TVCLK_ADDR A:0x61ad0308
y.create.l HWIO_MDSS_MDP_TEST_MISR_CURR_VAL_TVCLK_ADDR A:0x61ad030c
y.create.l HWIO_MDSS_MDP_TEST_CAPTURED_TVCLK_ADDR A:0x61ad0310
y.create.l HWIO_MDSS_MDP_TEST_MISR_CAPT_VAL_TVCLK_ADDR A:0x61ad0314
y.create.l HWIO_MDSS_MDP_TEST_MODE_DSI_PCLK_ADDR A:0x61ad0400
y.create.l HWIO_MDSS_MDP_TEST_MISR_RESET_DSI_PCLK_ADDR A:0x61ad0404
y.create.l HWIO_MDSS_MDP_TEST_EXPORT_MISR_DSI_PCLK_ADDR A:0x61ad0408
y.create.l HWIO_MDSS_MDP_TEST_MISR_CURR_VAL_DSI_PCLK_ADDR A:0x61ad040c
y.create.l HWIO_MDSS_MDP_TEST_CAPTURED_DSI_PCLK_ADDR A:0x61ad0410
y.create.l HWIO_MDSS_MDP_TEST_MISR_CAPT_VAL_DSI_PCLK_ADDR A:0x61ad0414
y.create.l HWIO_MDSS_MDP_TEST_MISR_TESTBUS_CAPT_VAL_ADDR A:0x61ad0600
y.create.l HWIO_MDSS_MDP_LCDC_EN_ADDR A:0x61ae0000
y.create.l HWIO_MDSS_MDP_LCDC_HSYNC_CTL_ADDR A:0x61ae0004
y.create.l HWIO_MDSS_MDP_LCDC_VSYNC_PERIOD_ADDR A:0x61ae0008
y.create.l HWIO_MDSS_MDP_LCDC_VSYNC_PULSE_WIDTH_ADDR A:0x61ae000c
y.create.l HWIO_MDSS_MDP_LCDC_DISPLAY_HCTL_ADDR A:0x61ae0010
y.create.l HWIO_MDSS_MDP_LCDC_DISPLAY_V_START_ADDR A:0x61ae0014
y.create.l HWIO_MDSS_MDP_LCDC_DISPLAY_V_END_ADDR A:0x61ae0018
y.create.l HWIO_MDSS_MDP_LCDC_ACTIVE_HCTL_ADDR A:0x61ae001c
y.create.l HWIO_MDSS_MDP_LCDC_ACTIVE_V_START_ADDR A:0x61ae0020
y.create.l HWIO_MDSS_MDP_LCDC_ACTIVE_V_END_ADDR A:0x61ae0024
y.create.l HWIO_MDSS_MDP_LCDC_BORDER_CLR_ADDR A:0x61ae0028
y.create.l HWIO_MDSS_MDP_LCDC_UNDERFLOW_CTL_ADDR A:0x61ae002c
y.create.l HWIO_MDSS_MDP_LCDC_HSYNC_SKEW_ADDR A:0x61ae0030
y.create.l HWIO_MDSS_MDP_LCDC_TEST_CTL_ADDR A:0x61ae0034
y.create.l HWIO_MDSS_MDP_LCDC_CTL_POLARITY_ADDR A:0x61ae0038
y.create.l HWIO_MDSS_MDP_LCDC_TEST_COL_VAR1_ADDR A:0x61ae003c
y.create.l HWIO_MDSS_MDP_LCDC_TEST_COL_VAR2_ADDR A:0x61ae0040
y.create.l HWIO_MDSS_MDP_LCDC_UFLOW_HIDING_CTL_ADDR A:0x61ae0044
y.create.l HWIO_MDSS_MDP_LCDC_LOST_PIXEL_CNT_VALUE_ADDR A:0x61ae0048
y.create.l HWIO_MDSS_MDP_DSI_VIDEO_EN_ADDR A:0x61af0000
y.create.l HWIO_MDSS_MDP_DSI_VIDEO_HSYNC_CTL_ADDR A:0x61af0004
y.create.l HWIO_MDSS_MDP_DSI_VIDEO_VSYNC_PERIOD_ADDR A:0x61af0008
y.create.l HWIO_MDSS_MDP_DSI_VIDEO_VSYNC_PULSE_WIDTH_ADDR A:0x61af000c
y.create.l HWIO_MDSS_MDP_DSI_VIDEO_DISPLAY_HCTL_ADDR A:0x61af0010
y.create.l HWIO_MDSS_MDP_DSI_VIDEO_DISPLAY_V_START_ADDR A:0x61af0014
y.create.l HWIO_MDSS_MDP_DSI_VIDEO_DISPLAY_V_END_ADDR A:0x61af0018
y.create.l HWIO_MDSS_MDP_DSI_VIDEO_ACTIVE_HCTL_ADDR A:0x61af001c
y.create.l HWIO_MDSS_MDP_DSI_VIDEO_ACTIVE_V_START_ADDR A:0x61af0020
y.create.l HWIO_MDSS_MDP_DSI_VIDEO_ACTIVE_V_END_ADDR A:0x61af0024
y.create.l HWIO_MDSS_MDP_DSI_VIDEO_BORDER_CLR_ADDR A:0x61af0028
y.create.l HWIO_MDSS_MDP_DSI_VIDEO_UNDERFLOW_CTL_ADDR A:0x61af002c
y.create.l HWIO_MDSS_MDP_DSI_VIDEO_HSYNC_SKEW_ADDR A:0x61af0030
y.create.l HWIO_MDSS_MDP_DSI_VIDEO_TEST_CTL_ADDR A:0x61af0034
y.create.l HWIO_MDSS_MDP_DSI_VIDEO_CTL_POLARITY_ADDR A:0x61af0038
y.create.l HWIO_MDSS_MDP_DSI_VIDEO_TEST_COL_VAR1_ADDR A:0x61af003c
y.create.l HWIO_MDSS_MDP_DSI_VIDEO_TEST_COL_VAR2_ADDR A:0x61af0040
y.create.l HWIO_MDSS_MDP_DSI_VIDEO_UFLOW_HIDING_CTL_ADDR A:0x61af0044
y.create.l HWIO_MDSS_MDP_DSI_VIDEO_LOST_PIXEL_CNT_VALUE_ADDR A:0x61af0048
y.create.l HWIO_MDSS_MDP_DSI_CMD_MODE_ID_MAP_ADDR A:0x61af1000
y.create.l HWIO_MDSS_MDP_DSI_CMD_MODE_TRIGGER_EN_ADDR A:0x61af1004
y.create.l HWIO_MDSS_DSI_0_HW_VERSION_ADDR A:0x61ac8000
y.create.l HWIO_MDSS_DSI_0_CTRL_ADDR A:0x61ac8004
y.create.l HWIO_MDSS_DSI_0_STATUS_ADDR A:0x61ac8008
y.create.l HWIO_MDSS_DSI_0_FIFO_STATUS_ADDR A:0x61ac800c
y.create.l HWIO_MDSS_DSI_0_VIDEO_MODE_CTRL_ADDR A:0x61ac8010
y.create.l HWIO_MDSS_DSI_0_VIDEO_MODE_SYNC_DATATYPE_ADDR A:0x61ac8014
y.create.l HWIO_MDSS_DSI_0_VIDEO_MODE_PIXEL_DATATYPE_ADDR A:0x61ac8018
y.create.l HWIO_MDSS_DSI_0_VIDEO_MODE_BLANKING_DATATYPE_ADDR A:0x61ac801c
y.create.l HWIO_MDSS_DSI_0_VIDEO_MODE_DATA_CTRL_ADDR A:0x61ac8020
y.create.l HWIO_MDSS_DSI_0_VIDEO_MODE_ACTIVE_H_ADDR A:0x61ac8024
y.create.l HWIO_MDSS_DSI_0_VIDEO_MODE_ACTIVE_V_ADDR A:0x61ac8028
y.create.l HWIO_MDSS_DSI_0_VIDEO_MODE_TOTAL_ADDR A:0x61ac802c
y.create.l HWIO_MDSS_DSI_0_VIDEO_MODE_HSYNC_ADDR A:0x61ac8030
y.create.l HWIO_MDSS_DSI_0_VIDEO_MODE_VSYNC_ADDR A:0x61ac8034
y.create.l HWIO_MDSS_DSI_0_VIDEO_MODE_VSYNC_VPOS_ADDR A:0x61ac8038
y.create.l HWIO_MDSS_DSI_0_COMMAND_MODE_DMA_CTRL_ADDR A:0x61ac803c
y.create.l HWIO_MDSS_DSI_0_COMMAND_MODE_MDP_CTRL_ADDR A:0x61ac8040
y.create.l HWIO_MDSS_DSI_0_COMMAND_MODE_MDP_DCS_CMD_CTRL_ADDR A:0x61ac8044
y.create.l HWIO_MDSS_DSI_0_DMA_CMD_OFFSET_ADDR A:0x61ac8048
y.create.l HWIO_MDSS_DSI_0_DMA_CMD_LENGTH_ADDR A:0x61ac804c
y.create.l HWIO_MDSS_DSI_0_DMA_FIFO_CTRL_ADDR A:0x61ac8050
y.create.l HWIO_MDSS_DSI_0_DMA_NULL_PACKET_DATA_ADDR A:0x61ac8054
y.create.l HWIO_MDSS_DSI_0_COMMAND_MODE_MDP_STREAM0_CTRL_ADDR A:0x61ac8058
y.create.l HWIO_MDSS_DSI_0_COMMAND_MODE_MDP_STREAM0_TOTAL_ADDR A:0x61ac805c
y.create.l HWIO_MDSS_DSI_0_COMMAND_MODE_MDP_STREAM1_CTRL_ADDR A:0x61ac8060
y.create.l HWIO_MDSS_DSI_0_COMMAND_MODE_MDP_STREAM1_TOTAL_ADDR A:0x61ac8064
y.create.l HWIO_MDSS_DSI_0_ACK_ERR_STATUS_ADDR A:0x61ac8068
y.create.l HWIO_MDSS_DSI_0_RDBK_DATA0_ADDR A:0x61ac806c
y.create.l HWIO_MDSS_DSI_0_RDBK_DATA1_ADDR A:0x61ac8070
y.create.l HWIO_MDSS_DSI_0_RDBK_DATA2_ADDR A:0x61ac8074
y.create.l HWIO_MDSS_DSI_0_RDBK_DATA3_ADDR A:0x61ac8078
y.create.l HWIO_MDSS_DSI_0_RDBK_DATATYPE0_ADDR A:0x61ac807c
y.create.l HWIO_MDSS_DSI_0_RDBK_DATATYPE1_ADDR A:0x61ac8080
y.create.l HWIO_MDSS_DSI_0_TRIG_CTRL_ADDR A:0x61ac8084
y.create.l HWIO_MDSS_DSI_0_EXT_MUX_ADDR A:0x61ac8088
y.create.l HWIO_MDSS_DSI_0_EXT_TE_PULSE_DETECT_CTRL_ADDR A:0x61ac808c
y.create.l HWIO_MDSS_DSI_0_CMD_MODE_DMA_SW_TRIGGER_ADDR A:0x61ac8090
y.create.l HWIO_MDSS_DSI_0_CMD_MODE_MDP_SW_TRIGGER_ADDR A:0x61ac8094
y.create.l HWIO_MDSS_DSI_0_CMD_MODE_BTA_SW_TRIGGER_ADDR A:0x61ac8098
y.create.l HWIO_MDSS_DSI_0_RESET_SW_TRIGGER_ADDR A:0x61ac809c
y.create.l HWIO_MDSS_DSI_0_MISR_CMD_CTRL_ADDR A:0x61ac80a0
y.create.l HWIO_MDSS_DSI_0_MISR_VIDEO_CTRL_ADDR A:0x61ac80a4
y.create.l HWIO_MDSS_DSI_0_LANE_STATUS_ADDR A:0x61ac80a8
y.create.l HWIO_MDSS_DSI_0_LANE_CTRL_ADDR A:0x61ac80ac
y.create.l HWIO_MDSS_DSI_0_LANE_SWAP_CTRL_ADDR A:0x61ac80b0
y.create.l HWIO_MDSS_DSI_0_DLN0_PHY_ERR_ADDR A:0x61ac80b4
y.create.l HWIO_MDSS_DSI_0_LP_TIMER_CTRL_ADDR A:0x61ac80b8
y.create.l HWIO_MDSS_DSI_0_HS_TIMER_CTRL_ADDR A:0x61ac80bc
y.create.l HWIO_MDSS_DSI_0_TIMEOUT_STATUS_ADDR A:0x61ac80c0
y.create.l HWIO_MDSS_DSI_0_CLKOUT_TIMING_CTRL_ADDR A:0x61ac80c4
y.create.l HWIO_MDSS_DSI_0_EOT_PACKET_ADDR A:0x61ac80c8
y.create.l HWIO_MDSS_DSI_0_EOT_PACKET_CTRL_ADDR A:0x61ac80cc
y.create.l HWIO_MDSS_DSI_0_GENERIC_ESC_TX_TRIGGER_ADDR A:0x61ac80d0
y.create.l HWIO_MDSS_DSI_0_CAM_BIST_CTRL_ADDR A:0x61ac80d4
y.create.l HWIO_MDSS_DSI_0_CAM_BIST_FRAME_SIZE_ADDR A:0x61ac80d8
y.create.l HWIO_MDSS_DSI_0_CAM_BIST_BLOCK_SIZE_ADDR A:0x61ac80dc
y.create.l HWIO_MDSS_DSI_0_CAM_BIST_FRAME_CONFIG_ADDR A:0x61ac80e0
y.create.l HWIO_MDSS_DSI_0_CAM_BIST_LSFR_CTRL_ADDR A:0x61ac80e4
y.create.l HWIO_MDSS_DSI_0_CAM_BIST_LSFR_INIT_ADDR A:0x61ac80e8
y.create.l HWIO_MDSS_DSI_0_CAM_BIST_START_ADDR A:0x61ac80ec
y.create.l HWIO_MDSS_DSI_0_CAM_BIST_STATUS_ADDR A:0x61ac80f0
y.create.l HWIO_MDSS_DSI_0_ERR_INT_MASK0_ADDR A:0x61ac810c
y.create.l HWIO_MDSS_DSI_0_INT_CTRL_ADDR A:0x61ac8110
y.create.l HWIO_MDSS_DSI_0_IOBIST_CTRL_ADDR A:0x61ac8114
y.create.l HWIO_MDSS_DSI_0_SOFT_RESET_ADDR A:0x61ac8118
y.create.l HWIO_MDSS_DSI_0_CLK_CTRL_ADDR A:0x61ac811c
y.create.l HWIO_MDSS_DSI_0_CLK_STATUS_ADDR A:0x61ac8120
y.create.l HWIO_MDSS_DSI_0_DEBUG_BUS_CTRL_ADDR A:0x61ac8124
y.create.l HWIO_MDSS_DSI_0_DEBUG_BUS_ADDR A:0x61ac8128
y.create.l HWIO_MDSS_DSI_0_PHY_SW_RESET_ADDR A:0x61ac812c
y.create.l HWIO_MDSS_DSI_0_AXI2AHB_CTRL_ADDR A:0x61ac8130
y.create.l HWIO_MDSS_DSI_0_MISR_CMD_MDP0_32BIT_ADDR A:0x61ac8134
y.create.l HWIO_MDSS_DSI_0_MISR_CMD_MDP1_32BIT_ADDR A:0x61ac8138
y.create.l HWIO_MDSS_DSI_0_MISR_CMD_DMA_32BIT_ADDR A:0x61ac813c
y.create.l HWIO_MDSS_DSI_0_MISR_VIDEO_32BIT_ADDR A:0x61ac8140
y.create.l HWIO_MDSS_DSI_0_LANE_MISR_CTRL_ADDR A:0x61ac8144
y.create.l HWIO_MDSS_DSI_0_LANE0_MISR_ADDR A:0x61ac8148
y.create.l HWIO_MDSS_DSI_0_LANE1_MISR_ADDR A:0x61ac814c
y.create.l HWIO_MDSS_DSI_0_LANE2_MISR_ADDR A:0x61ac8150
y.create.l HWIO_MDSS_DSI_0_LANE3_MISR_ADDR A:0x61ac8154
y.create.l HWIO_MDSS_DSI_0_TEST_PATTERN_GEN_CTRL_ADDR A:0x61ac815c
y.create.l HWIO_MDSS_DSI_0_TEST_PATTERN_GEN_VIDEO_POLY_ADDR A:0x61ac8160
y.create.l HWIO_MDSS_DSI_0_TEST_PATTERN_GEN_VIDEO_INIT_VAL_ADDR A:0x61ac8164
y.create.l HWIO_MDSS_DSI_0_TEST_PATTERN_GEN_CMD_MDP_STREAM0_POLY_ADDR A:0x61ac8168
y.create.l HWIO_MDSS_DSI_0_TEST_PATTERN_GEN_CMD_MDP_INIT_VAL0_ADDR A:0x61ac816c
y.create.l HWIO_MDSS_DSI_0_TEST_PATTERN_GEN_CMD_MDP_STREAM1_POLY_ADDR A:0x61ac8170
y.create.l HWIO_MDSS_DSI_0_TEST_PATTERN_GEN_CMD_MDP_INIT_VAL1_ADDR A:0x61ac8174
y.create.l HWIO_MDSS_DSI_0_TEST_PATTERN_GEN_CMD_DMA_POLY_ADDR A:0x61ac8178
y.create.l HWIO_MDSS_DSI_0_TEST_PATTERN_GEN_CMD_DMA_INIT_VAL_ADDR A:0x61ac817c
y.create.l HWIO_MDSS_DSI_0_TEST_PATTERN_GEN_VIDEO_ENABLE_ADDR A:0x61ac8180
y.create.l HWIO_MDSS_DSI_0_TEST_PATTERN_GEN_CMD_STREAM0_TRIGGER_ADDR A:0x61ac8184
y.create.l HWIO_MDSS_DSI_0_TEST_PATTERN_GEN_CMD_STREAM1_TRIGGER_ADDR A:0x61ac8188
y.create.l HWIO_MDSS_DSI_0_TEST_PATTERN_GEN_CMD_MDP_INIT_VAL2_ADDR A:0x61ac818c
y.create.l HWIO_MDSS_DSI_0_TEST_PATTERN_GEN_CMD_MDP_STREAM2_POLY_ADDR A:0x61ac8190
y.create.l HWIO_MDSS_DSI_0_COMMAND_MODE_MDP_IDLE_CTRL_ADDR A:0x61ac8194
y.create.l HWIO_MDSS_DSI_0_TEST_PATTERN_GEN_CMD_STREAM2_TRIGGER_ADDR A:0x61ac8198
y.create.l HWIO_MDSS_DSI_0_TPG_MAIN_CONTROL_ADDR A:0x61ac819c
y.create.l HWIO_MDSS_DSI_0_TPG_MAIN_CONTROL2_ADDR A:0x61ac81a0
y.create.l HWIO_MDSS_DSI_0_TPG_VIDEO_CONFIG_ADDR A:0x61ac81a4
y.create.l HWIO_MDSS_DSI_0_TPG_COMPONENT_LIMITS_ADDR A:0x61ac81a8
y.create.l HWIO_MDSS_DSI_0_TPG_RECTANGLE_ADDR A:0x61ac81ac
y.create.l HWIO_MDSS_DSI_0_TPG_BLACK_WHITE_PATTERN_FRAMES_ADDR A:0x61ac81b0
y.create.l HWIO_MDSS_DSI_0_TPG_RGB_MAPPING_ADDR A:0x61ac81b4
y.create.l HWIO_MDSS_DSI_0_COMMAND_MODE_MDP_CTRL2_ADDR A:0x61ac81b8
y.create.l HWIO_MDSS_DSI_0_COMMAND_MODE_MDP_STREAM2_CTRL_ADDR A:0x61ac81bc
y.create.l HWIO_MDSS_DSI_0_COMMAND_MODE_MDP_STREAM2_TOTAL_ADDR A:0x61ac81c0
y.create.l HWIO_MDSS_DSI_0_MISR_CMD_MDP2_8BIT_ADDR A:0x61ac81c4
y.create.l HWIO_MDSS_DSI_0_MISR_CMD_MDP2_32BIT_ADDR A:0x61ac81c8
y.create.l HWIO_MDSS_DSI_0_VBIF_CTRL_ADDR A:0x61ac81cc
y.create.l HWIO_MDSS_DSI_0_AES_CTRL_ADDR A:0x61ac81d0
y.create.l HWIO_MDSS_DSI_0_RDBK_DATA_CTRL_ADDR A:0x61ac81d4
y.create.l HWIO_MDSS_DSI_0_TEST_PATTERN_GEN_CMD_DMA_INIT_VAL2_ADDR A:0x61ac81d8
y.create.l HWIO_MDSS_DSI_0_TPG_DMA_FIFO_STATUS_ADDR A:0x61ac81dc
y.create.l HWIO_MDSS_DSI_0_TPG_DMA_FIFO_WRITE_TRIGGER_ADDR A:0x61ac81e0
y.create.l HWIO_MDSS_DSI_0_DSI_TIMING_FLUSH_ADDR A:0x61ac81e4
y.create.l HWIO_MDSS_DSI_0_DSI_TIMING_DB_MODE_ADDR A:0x61ac81e8
y.create.l HWIO_MDSS_DSI_0_TPG_DMA_FIFO_RESET_ADDR A:0x61ac81ec
y.create.l HWIO_MDSS_DSI_0_SCRATCH_REGISTER_0_ADDR A:0x61ac81f0
y.create.l HWIO_MDSS_DSI_0_VERSION_ADDR A:0x61ac81f4
y.create.l HWIO_MDSS_DSI_0_SCRATCH_REGISTER_1_ADDR A:0x61ac81f8
y.create.l HWIO_MDSS_DSI_0_SCRATCH_REGISTER_2_ADDR A:0x61ac81fc
y.create.l HWIO_MDSS_DSI_0_DYNAMIC_REFRESH_CTRL_ADDR A:0x61ac8200
y.create.l HWIO_MDSS_DSI_0_DYNAMIC_REFRESH_PIPE_DELAY_ADDR A:0x61ac8204
y.create.l HWIO_MDSS_DSI_0_DYNAMIC_REFRESH_PIPE_DELAY2_ADDR A:0x61ac8208
y.create.l HWIO_MDSS_DSI_0_DYNAMIC_REFRESH_PLL_DELAY_ADDR A:0x61ac820c
y.create.l HWIO_MDSS_DSI_0_DYNAMIC_REFRESH_STATUS_ADDR A:0x61ac8210
y.create.l HWIO_MDSS_DSI_0_DYNAMIC_REFRESH_PLL_CTRL0_ADDR A:0x61ac8214
y.create.l HWIO_MDSS_DSI_0_DYNAMIC_REFRESH_PLL_CTRL1_ADDR A:0x61ac8218
y.create.l HWIO_MDSS_DSI_0_DYNAMIC_REFRESH_PLL_CTRL2_ADDR A:0x61ac821c
y.create.l HWIO_MDSS_DSI_0_DYNAMIC_REFRESH_PLL_CTRL3_ADDR A:0x61ac8220
y.create.l HWIO_MDSS_DSI_0_DYNAMIC_REFRESH_PLL_CTRL4_ADDR A:0x61ac8224
y.create.l HWIO_MDSS_DSI_0_DYNAMIC_REFRESH_PLL_CTRL5_ADDR A:0x61ac8228
y.create.l HWIO_MDSS_DSI_0_DYNAMIC_REFRESH_PLL_CTRL6_ADDR A:0x61ac822c
y.create.l HWIO_MDSS_DSI_0_DYNAMIC_REFRESH_PLL_CTRL7_ADDR A:0x61ac8230
y.create.l HWIO_MDSS_DSI_0_DYNAMIC_REFRESH_PLL_CTRL8_ADDR A:0x61ac8234
y.create.l HWIO_MDSS_DSI_0_DYNAMIC_REFRESH_PLL_CTRL9_ADDR A:0x61ac8238
y.create.l HWIO_MDSS_DSI_0_DYNAMIC_REFRESH_PLL_CTRL10_ADDR A:0x61ac823c
y.create.l HWIO_MDSS_DSI_0_DYNAMIC_REFRESH_PLL_CTRL11_ADDR A:0x61ac8240
y.create.l HWIO_MDSS_DSI_0_DYNAMIC_REFRESH_PLL_CTRL12_ADDR A:0x61ac8244
y.create.l HWIO_MDSS_DSI_0_DYNAMIC_REFRESH_PLL_CTRL13_ADDR A:0x61ac8248
y.create.l HWIO_MDSS_DSI_0_DYNAMIC_REFRESH_PLL_CTRL14_ADDR A:0x61ac824c
y.create.l HWIO_MDSS_DSI_0_DYNAMIC_REFRESH_PLL_CTRL15_ADDR A:0x61ac8250
y.create.l HWIO_MDSS_DSI_0_DYNAMIC_REFRESH_PLL_CTRL16_ADDR A:0x61ac8254
y.create.l HWIO_MDSS_DSI_0_DYNAMIC_REFRESH_PLL_CTRL17_ADDR A:0x61ac8258
y.create.l HWIO_MDSS_DSI_0_PHY_PLL_UNIPHY_PLL_REFCLK_CFG_ADDR A:0x61ac8300
y.create.l HWIO_MDSS_DSI_0_PHY_PLL_UNIPHY_PLL_POSTDIV1_CFG_ADDR A:0x61ac8304
y.create.l HWIO_MDSS_DSI_0_PHY_PLL_UNIPHY_PLL_CHGPUMP_CFG_ADDR A:0x61ac8308
y.create.l HWIO_MDSS_DSI_0_PHY_PLL_UNIPHY_PLL_VCOLPF_CFG_ADDR A:0x61ac830c
y.create.l HWIO_MDSS_DSI_0_PHY_PLL_UNIPHY_PLL_VREG_CFG_ADDR A:0x61ac8310
y.create.l HWIO_MDSS_DSI_0_PHY_PLL_UNIPHY_PLL_PWRGEN_CFG_ADDR A:0x61ac8314
y.create.l HWIO_MDSS_DSI_0_PHY_PLL_UNIPHY_PLL_DMUX_CFG_ADDR A:0x61ac8318
y.create.l HWIO_MDSS_DSI_0_PHY_PLL_UNIPHY_PLL_AMUX_CFG_ADDR A:0x61ac831c
y.create.l HWIO_MDSS_DSI_0_PHY_PLL_UNIPHY_PLL_GLB_CFG_ADDR A:0x61ac8320
y.create.l HWIO_MDSS_DSI_0_PHY_PLL_UNIPHY_PLL_POSTDIV2_CFG_ADDR A:0x61ac8324
y.create.l HWIO_MDSS_DSI_0_PHY_PLL_UNIPHY_PLL_POSTDIV3_CFG_ADDR A:0x61ac8328
y.create.l HWIO_MDSS_DSI_0_PHY_PLL_UNIPHY_PLL_LPFR_CFG_ADDR A:0x61ac832c
y.create.l HWIO_MDSS_DSI_0_PHY_PLL_UNIPHY_PLL_LPFC1_CFG_ADDR A:0x61ac8330
y.create.l HWIO_MDSS_DSI_0_PHY_PLL_UNIPHY_PLL_LPFC2_CFG_ADDR A:0x61ac8334
y.create.l HWIO_MDSS_DSI_0_PHY_PLL_UNIPHY_PLL_SDM_CFG0_ADDR A:0x61ac8338
y.create.l HWIO_MDSS_DSI_0_PHY_PLL_UNIPHY_PLL_SDM_CFG1_ADDR A:0x61ac833c
y.create.l HWIO_MDSS_DSI_0_PHY_PLL_UNIPHY_PLL_SDM_CFG2_ADDR A:0x61ac8340
y.create.l HWIO_MDSS_DSI_0_PHY_PLL_UNIPHY_PLL_SDM_CFG3_ADDR A:0x61ac8344
y.create.l HWIO_MDSS_DSI_0_PHY_PLL_UNIPHY_PLL_SDM_CFG4_ADDR A:0x61ac8348
y.create.l HWIO_MDSS_DSI_0_PHY_PLL_UNIPHY_PLL_SSC_CFG0_ADDR A:0x61ac834c
y.create.l HWIO_MDSS_DSI_0_PHY_PLL_UNIPHY_PLL_SSC_CFG1_ADDR A:0x61ac8350
y.create.l HWIO_MDSS_DSI_0_PHY_PLL_UNIPHY_PLL_SSC_CFG2_ADDR A:0x61ac8354
y.create.l HWIO_MDSS_DSI_0_PHY_PLL_UNIPHY_PLL_SSC_CFG3_ADDR A:0x61ac8358
y.create.l HWIO_MDSS_DSI_0_PHY_PLL_UNIPHY_PLL_LKDET_CFG0_ADDR A:0x61ac835c
y.create.l HWIO_MDSS_DSI_0_PHY_PLL_UNIPHY_PLL_LKDET_CFG1_ADDR A:0x61ac8360
y.create.l HWIO_MDSS_DSI_0_PHY_PLL_UNIPHY_PLL_LKDET_CFG2_ADDR A:0x61ac8364
y.create.l HWIO_MDSS_DSI_0_PHY_PLL_UNIPHY_PLL_TEST_CFG_ADDR A:0x61ac8368
y.create.l HWIO_MDSS_DSI_0_PHY_PLL_UNIPHY_PLL_CAL_CFG0_ADDR A:0x61ac836c
y.create.l HWIO_MDSS_DSI_0_PHY_PLL_UNIPHY_PLL_CAL_CFG1_ADDR A:0x61ac8370
y.create.l HWIO_MDSS_DSI_0_PHY_PLL_UNIPHY_PLL_CAL_CFG2_ADDR A:0x61ac8374
y.create.l HWIO_MDSS_DSI_0_PHY_PLL_UNIPHY_PLL_CAL_CFG3_ADDR A:0x61ac8378
y.create.l HWIO_MDSS_DSI_0_PHY_PLL_UNIPHY_PLL_CAL_CFG4_ADDR A:0x61ac837c
y.create.l HWIO_MDSS_DSI_0_PHY_PLL_UNIPHY_PLL_CAL_CFG5_ADDR A:0x61ac8380
y.create.l HWIO_MDSS_DSI_0_PHY_PLL_UNIPHY_PLL_CAL_CFG6_ADDR A:0x61ac8384
y.create.l HWIO_MDSS_DSI_0_PHY_PLL_UNIPHY_PLL_CAL_CFG7_ADDR A:0x61ac8388
y.create.l HWIO_MDSS_DSI_0_PHY_PLL_UNIPHY_PLL_CAL_CFG8_ADDR A:0x61ac838c
y.create.l HWIO_MDSS_DSI_0_PHY_PLL_UNIPHY_PLL_CAL_CFG9_ADDR A:0x61ac8390
y.create.l HWIO_MDSS_DSI_0_PHY_PLL_UNIPHY_PLL_CAL_CFG10_ADDR A:0x61ac8394
y.create.l HWIO_MDSS_DSI_0_PHY_PLL_UNIPHY_PLL_CAL_CFG11_ADDR A:0x61ac8398
y.create.l HWIO_MDSS_DSI_0_PHY_PLL_UNIPHY_PLL_EFUSE_CFG_ADDR A:0x61ac839c
y.create.l HWIO_MDSS_DSI_0_PHY_PLL_UNIPHY_PLL_DEBUG_BUS_SEL_ADDR A:0x61ac83a0
y.create.l HWIO_MDSS_DSI_0_PHY_PLL_UNIPHY_PLL_CTRL_42_ADDR A:0x61ac83a4
y.create.l HWIO_MDSS_DSI_0_PHY_PLL_UNIPHY_PLL_CTRL_43_ADDR A:0x61ac83a8
y.create.l HWIO_MDSS_DSI_0_PHY_PLL_UNIPHY_PLL_CTRL_44_ADDR A:0x61ac83ac
y.create.l HWIO_MDSS_DSI_0_PHY_PLL_UNIPHY_PLL_CTRL_45_ADDR A:0x61ac83b0
y.create.l HWIO_MDSS_DSI_0_PHY_PLL_UNIPHY_PLL_CTRL_46_ADDR A:0x61ac83b4
y.create.l HWIO_MDSS_DSI_0_PHY_PLL_UNIPHY_PLL_CTRL_47_ADDR A:0x61ac83b8
y.create.l HWIO_MDSS_DSI_0_PHY_PLL_UNIPHY_PLL_CTRL_48_ADDR A:0x61ac83bc
y.create.l HWIO_MDSS_DSI_0_PHY_PLL_UNIPHY_PLL_STATUS_ADDR A:0x61ac83c0
y.create.l HWIO_MDSS_DSI_0_PHY_PLL_UNIPHY_PLL_DEBUG_BUS0_ADDR A:0x61ac83c4
y.create.l HWIO_MDSS_DSI_0_PHY_PLL_UNIPHY_PLL_DEBUG_BUS1_ADDR A:0x61ac83c8
y.create.l HWIO_MDSS_DSI_0_PHY_PLL_UNIPHY_PLL_DEBUG_BUS2_ADDR A:0x61ac83cc
y.create.l HWIO_MDSS_DSI_0_PHY_PLL_UNIPHY_PLL_DEBUG_BUS3_ADDR A:0x61ac83d0
y.create.l HWIO_MDSS_DSI_0_PHY_PLL_UNIPHY_PLL_CTRL_54_ADDR A:0x61ac83d4
y.create.l HWIO_MDSS_DSI_0_PHY_DSIPHY_LN0_CFG0_ADDR A:0x61ac8500
y.create.l HWIO_MDSS_DSI_0_PHY_DSIPHY_LN1_CFG0_ADDR A:0x61ac8540
y.create.l HWIO_MDSS_DSI_0_PHY_DSIPHY_LN2_CFG0_ADDR A:0x61ac8580
y.create.l HWIO_MDSS_DSI_0_PHY_DSIPHY_LN3_CFG0_ADDR A:0x61ac85c0
y.create.l HWIO_MDSS_DSI_0_PHY_DSIPHY_LN0_CFG1_ADDR A:0x61ac8504
y.create.l HWIO_MDSS_DSI_0_PHY_DSIPHY_LN1_CFG1_ADDR A:0x61ac8544
y.create.l HWIO_MDSS_DSI_0_PHY_DSIPHY_LN2_CFG1_ADDR A:0x61ac8584
y.create.l HWIO_MDSS_DSI_0_PHY_DSIPHY_LN3_CFG1_ADDR A:0x61ac85c4
y.create.l HWIO_MDSS_DSI_0_PHY_DSIPHY_LN0_CFG2_ADDR A:0x61ac8508
y.create.l HWIO_MDSS_DSI_0_PHY_DSIPHY_LN1_CFG2_ADDR A:0x61ac8548
y.create.l HWIO_MDSS_DSI_0_PHY_DSIPHY_LN2_CFG2_ADDR A:0x61ac8588
y.create.l HWIO_MDSS_DSI_0_PHY_DSIPHY_LN3_CFG2_ADDR A:0x61ac85c8
y.create.l HWIO_MDSS_DSI_0_PHY_DSIPHY_LN0_CFG3_ADDR A:0x61ac850c
y.create.l HWIO_MDSS_DSI_0_PHY_DSIPHY_LN1_CFG3_ADDR A:0x61ac854c
y.create.l HWIO_MDSS_DSI_0_PHY_DSIPHY_LN2_CFG3_ADDR A:0x61ac858c
y.create.l HWIO_MDSS_DSI_0_PHY_DSIPHY_LN3_CFG3_ADDR A:0x61ac85cc
y.create.l HWIO_MDSS_DSI_0_PHY_DSIPHY_LN0_CFG4_ADDR A:0x61ac8510
y.create.l HWIO_MDSS_DSI_0_PHY_DSIPHY_LN1_CFG4_ADDR A:0x61ac8550
y.create.l HWIO_MDSS_DSI_0_PHY_DSIPHY_LN2_CFG4_ADDR A:0x61ac8590
y.create.l HWIO_MDSS_DSI_0_PHY_DSIPHY_LN3_CFG4_ADDR A:0x61ac85d0
y.create.l HWIO_MDSS_DSI_0_PHY_DSIPHY_LN0_TEST_DATAPATH_ADDR A:0x61ac8514
y.create.l HWIO_MDSS_DSI_0_PHY_DSIPHY_LN1_TEST_DATAPATH_ADDR A:0x61ac8554
y.create.l HWIO_MDSS_DSI_0_PHY_DSIPHY_LN2_TEST_DATAPATH_ADDR A:0x61ac8594
y.create.l HWIO_MDSS_DSI_0_PHY_DSIPHY_LN3_TEST_DATAPATH_ADDR A:0x61ac85d4
y.create.l HWIO_MDSS_DSI_0_PHY_DSIPHY_LN0_DEBUG_SEL_ADDR A:0x61ac8518
y.create.l HWIO_MDSS_DSI_0_PHY_DSIPHY_LN1_DEBUG_SEL_ADDR A:0x61ac8558
y.create.l HWIO_MDSS_DSI_0_PHY_DSIPHY_LN2_DEBUG_SEL_ADDR A:0x61ac8598
y.create.l HWIO_MDSS_DSI_0_PHY_DSIPHY_LN3_DEBUG_SEL_ADDR A:0x61ac85d8
y.create.l HWIO_MDSS_DSI_0_PHY_DSIPHY_LN0_TEST_STR0_ADDR A:0x61ac851c
y.create.l HWIO_MDSS_DSI_0_PHY_DSIPHY_LN1_TEST_STR0_ADDR A:0x61ac855c
y.create.l HWIO_MDSS_DSI_0_PHY_DSIPHY_LN2_TEST_STR0_ADDR A:0x61ac859c
y.create.l HWIO_MDSS_DSI_0_PHY_DSIPHY_LN3_TEST_STR0_ADDR A:0x61ac85dc
y.create.l HWIO_MDSS_DSI_0_PHY_DSIPHY_LN0_TEST_STR1_ADDR A:0x61ac8520
y.create.l HWIO_MDSS_DSI_0_PHY_DSIPHY_LN1_TEST_STR1_ADDR A:0x61ac8560
y.create.l HWIO_MDSS_DSI_0_PHY_DSIPHY_LN2_TEST_STR1_ADDR A:0x61ac85a0
y.create.l HWIO_MDSS_DSI_0_PHY_DSIPHY_LN3_TEST_STR1_ADDR A:0x61ac85e0
y.create.l HWIO_MDSS_DSI_0_PHY_DSIPHY_LN0_BIST_CTL0_ADDR A:0x61ac8524
y.create.l HWIO_MDSS_DSI_0_PHY_DSIPHY_LN1_BIST_CTL0_ADDR A:0x61ac8564
y.create.l HWIO_MDSS_DSI_0_PHY_DSIPHY_LN2_BIST_CTL0_ADDR A:0x61ac85a4
y.create.l HWIO_MDSS_DSI_0_PHY_DSIPHY_LN3_BIST_CTL0_ADDR A:0x61ac85e4
y.create.l HWIO_MDSS_DSI_0_PHY_DSIPHY_LN0_BIST_CTL1_ADDR A:0x61ac8528
y.create.l HWIO_MDSS_DSI_0_PHY_DSIPHY_LN1_BIST_CTL1_ADDR A:0x61ac8568
y.create.l HWIO_MDSS_DSI_0_PHY_DSIPHY_LN2_BIST_CTL1_ADDR A:0x61ac85a8
y.create.l HWIO_MDSS_DSI_0_PHY_DSIPHY_LN3_BIST_CTL1_ADDR A:0x61ac85e8
y.create.l HWIO_MDSS_DSI_0_PHY_DSIPHY_LN0_BIST_RXCHK_STATUS_ADDR A:0x61ac852c
y.create.l HWIO_MDSS_DSI_0_PHY_DSIPHY_LN1_BIST_RXCHK_STATUS_ADDR A:0x61ac856c
y.create.l HWIO_MDSS_DSI_0_PHY_DSIPHY_LN2_BIST_RXCHK_STATUS_ADDR A:0x61ac85ac
y.create.l HWIO_MDSS_DSI_0_PHY_DSIPHY_LN3_BIST_RXCHK_STATUS_ADDR A:0x61ac85ec
y.create.l HWIO_MDSS_DSI_0_PHY_DSIPHY_LN0_HSTX_STR_STATUS_ADDR A:0x61ac8530
y.create.l HWIO_MDSS_DSI_0_PHY_DSIPHY_LN1_HSTX_STR_STATUS_ADDR A:0x61ac8570
y.create.l HWIO_MDSS_DSI_0_PHY_DSIPHY_LN2_HSTX_STR_STATUS_ADDR A:0x61ac85b0
y.create.l HWIO_MDSS_DSI_0_PHY_DSIPHY_LN3_HSTX_STR_STATUS_ADDR A:0x61ac85f0
y.create.l HWIO_MDSS_DSI_0_PHY_RSVD_1_PHY_LN0_ADDR A:0x61ac8534
y.create.l HWIO_MDSS_DSI_0_PHY_RSVD_1_PHY_LN1_ADDR A:0x61ac8574
y.create.l HWIO_MDSS_DSI_0_PHY_RSVD_1_PHY_LN2_ADDR A:0x61ac85b4
y.create.l HWIO_MDSS_DSI_0_PHY_RSVD_1_PHY_LN3_ADDR A:0x61ac85f4
y.create.l HWIO_MDSS_DSI_0_PHY_DSIPHY_LN0_BIST_MISR_STAT0_ADDR A:0x61ac8538
y.create.l HWIO_MDSS_DSI_0_PHY_DSIPHY_LN1_BIST_MISR_STAT0_ADDR A:0x61ac8578
y.create.l HWIO_MDSS_DSI_0_PHY_DSIPHY_LN2_BIST_MISR_STAT0_ADDR A:0x61ac85b8
y.create.l HWIO_MDSS_DSI_0_PHY_DSIPHY_LN3_BIST_MISR_STAT0_ADDR A:0x61ac85f8
y.create.l HWIO_MDSS_DSI_0_PHY_DSIPHY_LN0_BIST_MISR_STAT1_ADDR A:0x61ac853c
y.create.l HWIO_MDSS_DSI_0_PHY_DSIPHY_LN1_BIST_MISR_STAT1_ADDR A:0x61ac857c
y.create.l HWIO_MDSS_DSI_0_PHY_DSIPHY_LN2_BIST_MISR_STAT1_ADDR A:0x61ac85bc
y.create.l HWIO_MDSS_DSI_0_PHY_DSIPHY_LN3_BIST_MISR_STAT1_ADDR A:0x61ac85fc
y.create.l HWIO_MDSS_DSI_0_PHY_DSIPHY_LNCK_CFG0_ADDR A:0x61ac8600
y.create.l HWIO_MDSS_DSI_0_PHY_DSIPHY_LNCK_CFG1_ADDR A:0x61ac8604
y.create.l HWIO_MDSS_DSI_0_PHY_DSIPHY_LNCK_CFG2_ADDR A:0x61ac8608
y.create.l HWIO_MDSS_DSI_0_PHY_DSIPHY_LNCK_CFG3_ADDR A:0x61ac860c
y.create.l HWIO_MDSS_DSI_0_PHY_DSIPHY_LNCK_CFG4_ADDR A:0x61ac8610
y.create.l HWIO_MDSS_DSI_0_PHY_DSIPHY_LNCK_TEST_DATAPATH_ADDR A:0x61ac8614
y.create.l HWIO_MDSS_DSI_0_PHY_DSIPHY_LNCK_DEBUG_SEL_ADDR A:0x61ac8618
y.create.l HWIO_MDSS_DSI_0_PHY_DSIPHY_LNCK_TEST_STR0_ADDR A:0x61ac861c
y.create.l HWIO_MDSS_DSI_0_PHY_DSIPHY_LNCK_TEST_STR1_ADDR A:0x61ac8620
y.create.l HWIO_MDSS_DSI_0_PHY_DSIPHY_LNCK_BIST_CTL0_ADDR A:0x61ac8624
y.create.l HWIO_MDSS_DSI_0_PHY_DSIPHY_LNCK_BIST_CTL1_ADDR A:0x61ac8628
y.create.l HWIO_MDSS_DSI_0_PHY_DSIPHY_LNCK_BIST_RXCHK_STATUS_ADDR A:0x61ac862c
y.create.l HWIO_MDSS_DSI_0_PHY_DSIPHY_LNCK_HSTX_STR_STATUS_ADDR A:0x61ac8630
y.create.l HWIO_MDSS_DSI_0_PHY_RSVD_1_PHY_LNCK_ADDR A:0x61ac8634
y.create.l HWIO_MDSS_DSI_0_PHY_DSIPHY_LNCK_BIST_MISR_STAT0_ADDR A:0x61ac8638
y.create.l HWIO_MDSS_DSI_0_PHY_DSIPHY_LNCK_BIST_MISR_STAT1_ADDR A:0x61ac863c
y.create.l HWIO_MDSS_DSI_0_PHY_DSIPHY_TIMING_CTRL_0_ADDR A:0x61ac8640
y.create.l HWIO_MDSS_DSI_0_PHY_DSIPHY_TIMING_CTRL_1_ADDR A:0x61ac8644
y.create.l HWIO_MDSS_DSI_0_PHY_DSIPHY_TIMING_CTRL_2_ADDR A:0x61ac8648
y.create.l HWIO_MDSS_DSI_0_PHY_DSIPHY_TIMING_CTRL_3_ADDR A:0x61ac864c
y.create.l HWIO_MDSS_DSI_0_PHY_DSIPHY_TIMING_CTRL_4_ADDR A:0x61ac8650
y.create.l HWIO_MDSS_DSI_0_PHY_DSIPHY_TIMING_CTRL_5_ADDR A:0x61ac8654
y.create.l HWIO_MDSS_DSI_0_PHY_DSIPHY_TIMING_CTRL_6_ADDR A:0x61ac8658
y.create.l HWIO_MDSS_DSI_0_PHY_DSIPHY_TIMING_CTRL_7_ADDR A:0x61ac865c
y.create.l HWIO_MDSS_DSI_0_PHY_DSIPHY_TIMING_CTRL_8_ADDR A:0x61ac8660
y.create.l HWIO_MDSS_DSI_0_PHY_DSIPHY_TIMING_CTRL_9_ADDR A:0x61ac8664
y.create.l HWIO_MDSS_DSI_0_PHY_DSIPHY_TIMING_CTRL_10_ADDR A:0x61ac8668
y.create.l HWIO_MDSS_DSI_0_PHY_DSIPHY_TIMING_CTRL_11_ADDR A:0x61ac866c
y.create.l HWIO_MDSS_DSI_0_PHY_DSIPHY_CTRL_0_ADDR A:0x61ac8670
y.create.l HWIO_MDSS_DSI_0_PHY_DSIPHY_CTRL_1_ADDR A:0x61ac8674
y.create.l HWIO_MDSS_DSI_0_PHY_DSIPHY_CTRL_2_ADDR A:0x61ac8678
y.create.l HWIO_MDSS_DSI_0_PHY_DSIPHY_CTRL_3_ADDR A:0x61ac867c
y.create.l HWIO_MDSS_DSI_0_PHY_DSIPHY_CTRL_4_ADDR A:0x61ac8680
y.create.l HWIO_MDSS_DSI_0_PHY_DSIPHY_STRENGTH_CTRL_0_ADDR A:0x61ac8684
y.create.l HWIO_MDSS_DSI_0_PHY_DSIPHY_STRENGTH_CTRL_1_ADDR A:0x61ac8688
y.create.l HWIO_MDSS_DSI_0_PHY_DSIPHY_CAL_HW_TRIGGER_ADDR A:0x61ac868c
y.create.l HWIO_MDSS_DSI_0_PHY_DSIPHY_CAL_SW_CFG0_ADDR A:0x61ac8690
y.create.l HWIO_MDSS_DSI_0_PHY_DSIPHY_CAL_SW_CFG1_ADDR A:0x61ac8694
y.create.l HWIO_MDSS_DSI_0_PHY_DSIPHY_CAL_SW_CFG2_ADDR A:0x61ac8698
y.create.l HWIO_MDSS_DSI_0_PHY_DSIPHY_CAL_HW_CFG0_ADDR A:0x61ac869c
y.create.l HWIO_MDSS_DSI_0_PHY_DSIPHY_CAL_HW_CFG1_ADDR A:0x61ac86a0
y.create.l HWIO_MDSS_DSI_0_PHY_DSIPHY_CAL_HW_CFG2_ADDR A:0x61ac86a4
y.create.l HWIO_MDSS_DSI_0_PHY_DSIPHY_CAL_HW_CFG3_ADDR A:0x61ac86a8
y.create.l HWIO_MDSS_DSI_0_PHY_DSIPHY_CAL_HW_CFG4_ADDR A:0x61ac86ac
y.create.l HWIO_MDSS_DSI_0_PHY_DSIPHY_CAL_TEST_EFUSE_ADDR A:0x61ac86b0
y.create.l HWIO_MDSS_DSI_0_PHY_DSIPHY_BIST_CTRL0_ADDR A:0x61ac86b4
y.create.l HWIO_MDSS_DSI_0_PHY_DSIPHY_BIST_CTRL1_ADDR A:0x61ac86b8
y.create.l HWIO_MDSS_DSI_0_PHY_DSIPHY_BIST_CTRL2_ADDR A:0x61ac86bc
y.create.l HWIO_MDSS_DSI_0_PHY_DSIPHY_BIST_CTRL3_ADDR A:0x61ac86c0
y.create.l HWIO_MDSS_DSI_0_PHY_DSIPHY_BIST_CTRL4_ADDR A:0x61ac86c4
y.create.l HWIO_MDSS_DSI_0_PHY_DSIPHY_BIST_CTRL5_ADDR A:0x61ac86c8
y.create.l HWIO_MDSS_DSI_0_PHY_RSVD_1_PHY_DIGTOP_ADDR A:0x61ac86cc
y.create.l HWIO_MDSS_DSI_0_PHY_DSIPHY_GLBL_MISR_CTRL_ADDR A:0x61ac86d0
y.create.l HWIO_MDSS_DSI_0_PHY_DSIPHY_GLBL_TEST_CTRL_ADDR A:0x61ac86d4
y.create.l HWIO_MDSS_DSI_0_PHY_DSIPHY_GLBL_DIGTOP_DEBUG_SEL_ADDR A:0x61ac86d8
y.create.l HWIO_MDSS_DSI_0_PHY_DSIPHY_LDO_CNTRL_ADDR A:0x61ac86dc
y.create.l HWIO_MDSS_DSI_0_PHY_DSIPHY_REGULATOR_CAL_STATUS0_ADDR A:0x61ac86e0
y.create.l HWIO_MDSS_DSI_0_PHY_DSIPHY_REGULATOR_CAL_STATUS1_ADDR A:0x61ac86e4
y.create.l HWIO_MDSS_DSI_0_PHY_DSIPHY_GLBL_STATUS_DCC_SEL_P_ADDR A:0x61ac86e8
y.create.l HWIO_MDSS_DSI_0_PHY_DSIPHY_GLBL_STATUS_DCC_SEL_N_ADDR A:0x61ac86ec
y.create.l HWIO_MDSS_DSI_0_PHY_DSIPHY_GLBL_STATUS_DEBUG_BUS0_ADDR A:0x61ac86f0
y.create.l HWIO_MDSS_DSI_0_PHY_DSIPHY_GLBL_STATUS_DEBUG_BUS1_ADDR A:0x61ac86f4
y.create.l HWIO_MDSS_DSI_0_PHY_DSIPHY_GLBL_STATUS_DEBUG_BUS2_ADDR A:0x61ac86f8
y.create.l HWIO_MDSS_DSI_0_PHY_DSIPHY_GLBL_STATUS_DEBUG_BUS3_ADDR A:0x61ac86fc
y.create.l HWIO_MDSS_DSI_0_PHY_DSIPHY_REVISION_ID0_ADDR A:0x61ac8700
y.create.l HWIO_MDSS_DSI_0_PHY_DSIPHY_REVISION_ID1_ADDR A:0x61ac8704
y.create.l HWIO_MDSS_DSI_0_PHY_DSIPHY_REVISION_ID2_ADDR A:0x61ac8708
y.create.l HWIO_MDSS_DSI_0_PHY_DSIPHY_REVISION_ID3_ADDR A:0x61ac870c
y.create.l HWIO_MDSS_DSI_0_PHY_REG_DSIPHY_REGULATOR_CTRL_0_ADDR A:0x61ac8780
y.create.l HWIO_MDSS_DSI_0_PHY_REG_DSIPHY_REGULATOR_CTRL_1_ADDR A:0x61ac8784
y.create.l HWIO_MDSS_DSI_0_PHY_REG_DSIPHY_REGULATOR_CTRL_2_ADDR A:0x61ac8788
y.create.l HWIO_MDSS_DSI_0_PHY_REG_DSIPHY_REGULATOR_CTRL_3_ADDR A:0x61ac878c
y.create.l HWIO_MDSS_DSI_0_PHY_REG_DSIPHY_REGULATOR_CTRL_4_ADDR A:0x61ac8790
y.create.l HWIO_MDSS_DSI_0_PHY_REG_DSIPHY_REGULATOR_CTRL_5_ADDR A:0x61ac8794
y.create.l HWIO_MDSS_DSI_0_PHY_REG_DSIPHY_REGULATOR_CAL_PWR_CFG_ADDR A:0x61ac8798
y.create.l HWIO_MDSS_DSI_0_PHY_REG_DSIPHY_REGULATOR_CTRL_6_ADDR A:0x61ac879c
y.create.l HWIO_MDSS_DSI_0_PHY_REG_DSIPHY_REGULATOR_RSVD_1_ADDR A:0x61ac87a0
y.create.l HWIO_MDSS_DSI_0_PHY_REG_DSIPHY_REG_CAL_DBG_SEL_ADDR A:0x61ac87a4
y.create.l HWIO_MDSS_DSI_0_PHY_REG_DSIPHY_REG_DBG_STAT0_ADDR A:0x61ac87a8
y.create.l HWIO_MDSS_DSI_0_PHY_REG_DSIPHY_REG_DBG_STAT1_ADDR A:0x61ac87ac
y.create.l HWIO_MDSS_VBIF_VERSION_ADDR A:0x61ab0000
y.create.l HWIO_MDSS_VBIF_CLKON_ADDR A:0x61ab0004
y.create.l HWIO_MDSS_VBIF_CLK_FORCE_CTRL0_ADDR A:0x61ab0008
y.create.l HWIO_MDSS_VBIF_CLK_FORCE_CTRL1_ADDR A:0x61ab000c
y.create.l HWIO_MDSS_VBIF_QOS_OVERRIDE_EN_ADDR A:0x61ab0010
y.create.l HWIO_MDSS_VBIF_PRILVL_ACT_PROP_EN_ADDR A:0x61ab0014
y.create.l HWIO_MDSS_VBIF_QOS_OVERRIDE_REQPRI_ADDR A:0x61ab0018
y.create.l HWIO_MDSS_VBIF_QOS_OVERRIDE_PRILVL_ADDR A:0x61ab001c
y.create.l HWIO_MDSS_VBIF_QOS_REMAP_00_ADDR A:0x61ab0020
y.create.l HWIO_MDSS_VBIF_QOS_REMAP_01_ADDR A:0x61ab0024
y.create.l HWIO_MDSS_VBIF_QOS_REMAP_10_ADDR A:0x61ab0028
y.create.l HWIO_MDSS_VBIF_QOS_REMAP_11_ADDR A:0x61ab002c
y.create.l HWIO_MDSS_VBIF_IN_RD_LIM_CONF0_ADDR A:0x61ab00b0
y.create.l HWIO_MDSS_VBIF_IN_WR_LIM_CONF0_ADDR A:0x61ab00c0
y.create.l HWIO_MDSS_VBIF_OUT_RD_LIM_CONF0_ADDR A:0x61ab00d0
y.create.l HWIO_MDSS_VBIF_OUT_WR_LIM_CONF0_ADDR A:0x61ab00d4
y.create.l HWIO_MDSS_VBIF_DDR_OUT_MAX_BURST_ADDR A:0x61ab00d8
y.create.l HWIO_MDSS_VBIF_ISO_SYNC_ADDR A:0x61ab00e0
y.create.l HWIO_MDSS_VBIF_ARB_CTL_ADDR A:0x61ab00f0
y.create.l HWIO_MDSS_VBIF_DDR_ARB_CONF0_ADDR A:0x61ab00f4
y.create.l HWIO_MDSS_VBIF_FIXED_ARB_CONF0_ADDR A:0x61ab0100
y.create.l HWIO_MDSS_VBIF_ROUND_ROBIN_QOS_ARB_ADDR A:0x61ab0124
y.create.l HWIO_MDSS_VBIF_OUT_AXI_AMEMTYPE_CONF0_ADDR A:0x61ab0160
y.create.l HWIO_MDSS_VBIF_OUT_AXI_AINST_OVERRIDE_EN_ADDR A:0x61ab0168
y.create.l HWIO_MDSS_VBIF_OUT_AXI_AINST_ADDR A:0x61ab016c
y.create.l HWIO_MDSS_VBIF_OUT_AXI_ASHARED_ADDR A:0x61ab0170
y.create.l HWIO_MDSS_VBIF_OUT_AXI_AINNERSHARED_ADDR A:0x61ab0174
y.create.l HWIO_MDSS_VBIF_OUT_AXI_AOOO_EN_ADDR A:0x61ab0178
y.create.l HWIO_MDSS_VBIF_OUT_AXI_AOOO_ADDR A:0x61ab017c
y.create.l HWIO_MDSS_VBIF_OUT_AXI_ANOALLOCATE_ADDR A:0x61ab0180
y.create.l HWIO_MDSS_VBIF_WD_TIMEOUT_ADDR A:0x61ab0184
y.create.l HWIO_MDSS_VBIF_PND_ERR_ADDR A:0x61ab0190
y.create.l HWIO_MDSS_VBIF_SRC_ERR_ADDR A:0x61ab0194
y.create.l HWIO_MDSS_VBIF_ERR_MASK_ADDR A:0x61ab0198
y.create.l HWIO_MDSS_VBIF_ERR_CLR_ADDR A:0x61ab019c
y.create.l HWIO_MDSS_VBIF_ERR_INFO_ADDR A:0x61ab01a0
y.create.l HWIO_MDSS_VBIF_AXI_TEST_CTL_ADDR A:0x61ab01b0
y.create.l HWIO_MDSS_VBIF_AXI_TEST_OUT_ADDR A:0x61ab01b4
y.create.l HWIO_MDSS_VBIF_XIN_HALT_CTRL0_ADDR A:0x61ab0200
y.create.l HWIO_MDSS_VBIF_XIN_HALT_CTRL1_ADDR A:0x61ab0204
y.create.l HWIO_MDSS_VBIF_AXI_HALT_CTRL0_ADDR A:0x61ab0208
y.create.l HWIO_MDSS_VBIF_AXI_HALT_CTRL1_ADDR A:0x61ab020c
y.create.l HWIO_MDSS_VBIF_TEST_BUS_OUT_CTRL_ADDR A:0x61ab0210
y.create.l HWIO_MDSS_VBIF_TEST_BUS1_CTRL0_ADDR A:0x61ab0214
y.create.l HWIO_MDSS_VBIF_TEST_BUS1_CTRL1_ADDR A:0x61ab0218
y.create.l HWIO_MDSS_VBIF_TEST_BUS2_CTRL0_ADDR A:0x61ab021c
y.create.l HWIO_MDSS_VBIF_TEST_BUS2_CTRL1_ADDR A:0x61ab0220
y.create.l HWIO_MDSS_VBIF_TEST_BUS_AHB_CTRL_ADDR A:0x61ab022c
y.create.l HWIO_MDSS_VBIF_TEST_BUS_OUT_ADDR A:0x61ab0230
y.create.l HWIO_MDSS_VBIF_ATB_CONF0_ADDR A:0x61ab0240
y.create.l HWIO_MDSS_VBIF_ATB_CONF1_ADDR A:0x61ab0244
y.create.l HWIO_MDSS_VBIF_ATB_CONF2_ADDR A:0x61ab0248
y.create.l HWIO_MDSS_VBIF_ATB_CONF3_ADDR A:0x61ab024c
y.create.l HWIO_MDSS_VBIF_ATB_TEST_VALUE_ADDR A:0x61ab0250
y.create.l HWIO_MDSS_VBIF_STM_CONF_ADDR A:0x61ab0260
y.create.l HWIO_MDSS_VBIF_WR_BUF_FOR_AP_ADDR A:0x61ab0270
y.create.l HWIO_MDSS_VBIF_PERF_CNT_EN0_ADDR A:0x61ab0300
y.create.l HWIO_MDSS_VBIF_PERF_CNT_EN1_ADDR A:0x61ab0304
y.create.l HWIO_MDSS_VBIF_PERF_CNT_CLR0_ADDR A:0x61ab0320
y.create.l HWIO_MDSS_VBIF_PERF_CNT_CLR1_ADDR A:0x61ab0324
y.create.l HWIO_MDSS_VBIF_PERF_CNT_SEL0_ADDR A:0x61ab0340
y.create.l HWIO_MDSS_VBIF_PERF_CNT_SEL1_ADDR A:0x61ab0344
y.create.l HWIO_MDSS_VBIF_PERF_CNT_L0_ADDR A:0x61ab0360
y.create.l HWIO_MDSS_VBIF_PERF_CNT_L1_ADDR A:0x61ab0364
y.create.l HWIO_MDSS_VBIF_PERF_CNT_H0_ADDR A:0x61ab0380
y.create.l HWIO_MDSS_VBIF_PERF_CNT_H1_ADDR A:0x61ab0384
y.create.l HWIO_MDSS_VBIF_PERF_PWR_CNT_EN0_ADDR A:0x61ab0400
y.create.l HWIO_MDSS_VBIF_PERF_PWR_CNT_EN1_ADDR A:0x61ab0404
y.create.l HWIO_MDSS_VBIF_PERF_PWR_CNT_EN2_ADDR A:0x61ab0408
y.create.l HWIO_MDSS_VBIF_PERF_PWR_CNT_CLR0_ADDR A:0x61ab0420
y.create.l HWIO_MDSS_VBIF_PERF_PWR_CNT_CLR1_ADDR A:0x61ab0424
y.create.l HWIO_MDSS_VBIF_PERF_PWR_CNT_CLR2_ADDR A:0x61ab0428
y.create.l HWIO_MDSS_VBIF_PERF_PWR_CNT_L0_ADDR A:0x61ab0440
y.create.l HWIO_MDSS_VBIF_PERF_PWR_CNT_L1_ADDR A:0x61ab0444
y.create.l HWIO_MDSS_VBIF_PERF_PWR_CNT_L2_ADDR A:0x61ab0448
y.create.l HWIO_MDSS_VBIF_PERF_PWR_CNT_H0_ADDR A:0x61ab0460
y.create.l HWIO_MDSS_VBIF_PERF_PWR_CNT_H1_ADDR A:0x61ab0464
y.create.l HWIO_MDSS_VBIF_PERF_PWR_CNT_H2_ADDR A:0x61ab0468
y.create.l HWIO_MDSS_VBIF_MISR_CFG_A0_ADDR A:0x61ab0480
y.create.l HWIO_MDSS_VBIF_MISR_COUNTER_ADDR A:0x61ab0490
y.create.l HWIO_MDSS_VBIF_MISR_CLR_A0_ADDR A:0x61ab0494
y.create.l HWIO_MDSS_VBIF_MISR_A0_SIG0_ADDR A:0x61ab04a4
y.create.l HWIO_MDSS_VBIF_MISR_A0_SIG1_ADDR A:0x61ab04a8
y.create.l HWIO_MDSS_VBIF_MISR_A0_SIG2_ADDR A:0x61ab04ac
y.create.l HWIO_MDSS_VBIF_MISR_A0_SIG3_ADDR A:0x61ab04b0
y.create.l HWIO_MDSS_VBIF_ATB_EN_ADDR A:0x61ab1030
y.create.l HWIO_MDSS_VBIF_STM_EN_ADDR A:0x61ab1040
y.create.l HWIO_MDSS_VBIF_DDR_OUTPUT_RECOVERABLE_HALT_CTRL0_ADDR A:0x61ab2000
y.create.l HWIO_MDSS_VBIF_DDR_OUTPUT_RECOVERABLE_HALT_CTRL1_ADDR A:0x61ab2004
y.create.l HWIO_MPM2_MPM_PMIC_VDD_ON_CFG_1_ADDR A:0x604a0000
y.create.l HWIO_MPM2_MPM_PMIC_VDD_ON_CFG_2_ADDR A:0x604a0004
y.create.l HWIO_MPM2_MPM_PMIC_VDD_ON_CFG_3_ADDR A:0x604a0008
y.create.l HWIO_MPM2_MPM_PMIC_VDD_ON_CFG_4_ADDR A:0x604a000c
y.create.l HWIO_MPM2_MPM_PMIC_VDD_ON_CFG_5_ADDR A:0x604a0010
y.create.l HWIO_MPM2_MPM_PMIC_VDD_ON_CFG_6_ADDR A:0x604a0014
y.create.l HWIO_MPM2_MPM_PMIC_VDD_ON_CFG_7_ADDR A:0x604a0018
y.create.l HWIO_MPM2_MPM_PMIC_VDD_ON_CFG_8_ADDR A:0x604a001c
y.create.l HWIO_MPM2_MPM_PMIC_VDD_ON_CFG_9_ADDR A:0x604a0020
y.create.l HWIO_MPM2_MPM_PMIC_VDD_ON_CFG_10_ADDR A:0x604a0024
y.create.l HWIO_MPM2_MPM_PMIC_VDD_ON_CFG_11_ADDR A:0x604a0028
y.create.l HWIO_MPM2_MPM_PMIC_VDD_ON_CFG_12_ADDR A:0x604a002c
y.create.l HWIO_MPM2_MPM_PMIC_VDD_OFF_CFG_1_ADDR A:0x604a0030
y.create.l HWIO_MPM2_MPM_PMIC_VDD_OFF_CFG_2_ADDR A:0x604a0034
y.create.l HWIO_MPM2_MPM_PMIC_VDD_OFF_CFG_3_ADDR A:0x604a0038
y.create.l HWIO_MPM2_MPM_PMIC_VDD_OFF_CFG_4_ADDR A:0x604a003c
y.create.l HWIO_MPM2_MPM_PMIC_VDD_OFF_CFG_5_ADDR A:0x604a0040
y.create.l HWIO_MPM2_MPM_PMIC_VDD_OFF_CFG_6_ADDR A:0x604a0044
y.create.l HWIO_MPM2_MPM_PMIC_VDD_OFF_CFG_7_ADDR A:0x604a0048
y.create.l HWIO_MPM2_MPM_PMIC_VDD_OFF_CFG_8_ADDR A:0x604a004c
y.create.l HWIO_MPM2_MPM_PMIC_VDD_OFF_CFG_9_ADDR A:0x604a0050
y.create.l HWIO_MPM2_MPM_PMIC_VDD_OFF_CFG_10_ADDR A:0x604a0054
y.create.l HWIO_MPM2_MPM_PMIC_VDD_OFF_CFG_11_ADDR A:0x604a0058
y.create.l HWIO_MPM2_MPM_PMIC_VDD_OFF_CFG_12_ADDR A:0x604a005c
y.create.l HWIO_MPM2_MPM_SPMI_CMD_CFG_ADDR A:0x604a0060
y.create.l HWIO_MPM2_MPM_SPMI_CDIV_CNTRL_ADDR A:0x604a0064
y.create.l HWIO_MPM2_MPM_CXO_CTRL_ADDR A:0x604a0068
y.create.l HWIO_MPM2_MPM_PXO_OSC_CTRL_ADDR A:0x604a006c
y.create.l HWIO_MPM2_MPM_LOW_POWER_CFG_ADDR A:0x604a0070
y.create.l HWIO_MPM2_MPM_LOW_POWER_STATUS_ADDR A:0x604a0074
y.create.l HWIO_MPM2_MPM_CXO_POWER_RAMPUP_TIME_ADDR A:0x604a0078
y.create.l HWIO_MPM2_MPM_PXO_WARMUP_TIME_ADDR A:0x604a007c
y.create.l HWIO_MPM2_MPM_HARDWARE_RESTORED_ADDR A:0x604a0080
y.create.l HWIO_MPM2_MPM_INT_CLEAR_1_ADDR A:0x604a0084
y.create.l HWIO_MPM2_MPM_INT_CLEAR_2_ADDR A:0x604a0088
y.create.l HWIO_MPM2_MPM_INT_EN_1_ADDR A:0x604a008c
y.create.l HWIO_MPM2_MPM_INT_EN_2_ADDR A:0x604a0090
y.create.l HWIO_MPM2_MPM_INT_POLARITY_1_ADDR A:0x604a0094
y.create.l HWIO_MPM2_MPM_INT_POLARITY_2_ADDR A:0x604a0098
y.create.l HWIO_MPM2_MPM_DETECT_CTL_1_ADDR A:0x604a009c
y.create.l HWIO_MPM2_MPM_DETECT_CTL_2_ADDR A:0x604a00a0
y.create.l HWIO_MPM2_MPM_DETECT_CTL_3_ADDR A:0x604a00a4
y.create.l HWIO_MPM2_MPM_DETECT_CTL_4_ADDR A:0x604a00a8
y.create.l HWIO_MPM2_MPM_INT_STATUS_1_ADDR A:0x604a00ac
y.create.l HWIO_MPM2_MPM_INT_STATUS_2_ADDR A:0x604a00b0
y.create.l HWIO_MPM2_MPM_INT_WKUP_CLK_SEL_1_ADDR A:0x604a00b4
y.create.l HWIO_MPM2_MPM_INT_WKUP_CLK_SEL_2_ADDR A:0x604a00b8
y.create.l HWIO_MPM2_MPM_DEBUG_BUS_EN_ADDR A:0x604a00bc
y.create.l HWIO_MPM2_MPM_PEN_DEBOUNCE_CTL_ADDR A:0x604a00c0
y.create.l HWIO_MPM2_MPM_WARM_BOOT_CFG_ADDR A:0x604a00c4
y.create.l HWIO_MPM2_MPM_REG0_FILE_ADDR A:0x604a00c8
y.create.l HWIO_MPM2_MPM_REG1_FILE_ADDR A:0x604a00cc
y.create.l HWIO_MPM2_MPM_REG2_FILE_ADDR A:0x604a00d0
y.create.l HWIO_MPM2_MPM_REG3_FILE_ADDR A:0x604a00d4
y.create.l HWIO_MPM2_MPM_REG4_FILE_ADDR A:0x604a00d8
y.create.l HWIO_MPM2_MPM_REG5_FILE_ADDR A:0x604a00dc
y.create.l HWIO_MPM2_MPM_REG6_FILE_ADDR A:0x604a00e0
y.create.l HWIO_MPM2_MPM_REG7_FILE_ADDR A:0x604a00e4
y.create.l HWIO_MPM2_MPM_REG8_FILE_ADDR A:0x604a00e8
y.create.l HWIO_MPM2_MPM_CNTR_CLK_CONTROL_ADDR A:0x604a00ec
y.create.l HWIO_MPM2_MPM_CNTR_FRAC_ADDR A:0x604a00f0
y.create.l HWIO_MPM2_MPM_CNTR_INCR_DATA_ADDR A:0x604a00f4
y.create.l HWIO_MPM2_MPM_HW_ID_ADDR A:0x604a00f8
y.create.l HWIO_MPM2_MPM_CONTROL_CNTCR_ADDR A:0x604a1000
y.create.l HWIO_MPM2_MPM_CONTROL_CNTSR_ADDR A:0x604a1004
y.create.l HWIO_MPM2_MPM_CONTROL_CNTCV_LO_ADDR A:0x604a1008
y.create.l HWIO_MPM2_MPM_CONTROL_CNTCV_HI_ADDR A:0x604a100c
y.create.l HWIO_MPM2_MPM_CONTROL_CNTFID0_ADDR A:0x604a1020
y.create.l HWIO_MPM2_MPM_CONTROL_ID_ADDR A:0x604a1fd0
y.create.l HWIO_MPM2_MPM_READ_CNTCV_LO_ADDR A:0x604a2000
y.create.l HWIO_MPM2_MPM_READ_CNTCV_HI_ADDR A:0x604a2004
y.create.l HWIO_MPM2_MPM_READ_ID_ADDR A:0x604a2fd0
y.create.l HWIO_MPM2_MPM_SLEEP_TIMETICK_COUNT_VAL_ADDR A:0x604a3000
y.create.l HWIO_MPM2_QTMR_AC_CNTFRQ_ADDR A:0x604a4000
y.create.l HWIO_MPM2_QTMR_AC_CNTSR_ADDR A:0x604a4004
y.create.l HWIO_MPM2_QTMR_AC_CNTTID_ADDR A:0x604a4008
y.create.l HWIO_MPM2_QTMR_AC_CNTACR_0_ADDR A:0x604a4040
y.create.l HWIO_MPM2_QTMR_AC_CNTVOFF_LO_0_ADDR A:0x604a4080
y.create.l HWIO_MPM2_QTMR_AC_CNTVOFF_HI_0_ADDR A:0x604a4084
y.create.l HWIO_MPM2_QTMR_AC_CFG_ADDR A:0x604a4fc0
y.create.l HWIO_MPM2_QTMR_AC_VERSION_ADDR A:0x604a4fd0
y.create.l HWIO_MPM2_QTMR_V1_CNTPCT_LO_ADDR A:0x604a5000
y.create.l HWIO_MPM2_QTMR_V1_CNTPCT_HI_ADDR A:0x604a5004
y.create.l HWIO_MPM2_QTMR_V1_CNTVCT_LO_ADDR A:0x604a5008
y.create.l HWIO_MPM2_QTMR_V1_CNTVCT_HI_ADDR A:0x604a500c
y.create.l HWIO_MPM2_QTMR_V1_CNTFRQ_ADDR A:0x604a5010
y.create.l HWIO_MPM2_QTMR_V1_CNTPL0ACR_ADDR A:0x604a5014
y.create.l HWIO_MPM2_QTMR_V1_CNTVOFF_LO_ADDR A:0x604a5018
y.create.l HWIO_MPM2_QTMR_V1_CNTVOFF_HI_ADDR A:0x604a501c
y.create.l HWIO_MPM2_QTMR_V1_CNTP_CVAL_LO_ADDR A:0x604a5020
y.create.l HWIO_MPM2_QTMR_V1_CNTP_CVAL_HI_ADDR A:0x604a5024
y.create.l HWIO_MPM2_QTMR_V1_CNTP_TVAL_ADDR A:0x604a5028
y.create.l HWIO_MPM2_QTMR_V1_CNTP_CTL_ADDR A:0x604a502c
y.create.l HWIO_MPM2_QTMR_V1_CNTV_CVAL_LO_ADDR A:0x604a5030
y.create.l HWIO_MPM2_QTMR_V1_CNTV_CVAL_HI_ADDR A:0x604a5034
y.create.l HWIO_MPM2_QTMR_V1_CNTV_TVAL_ADDR A:0x604a5038
y.create.l HWIO_MPM2_QTMR_V1_CNTV_CTL_ADDR A:0x604a503c
y.create.l HWIO_MPM2_QTMR_V1_VERSION_ADDR A:0x604a5fd0
y.create.l HWIO_MPM2_MPM_TSYNC_CTL_ADDR A:0x604a6000
y.create.l HWIO_MPM2_MPM_TSYNC_CMD_ADDR A:0x604a6004
y.create.l HWIO_MPM2_MPM_TSYNC_START_ADDR A:0x604a6008
y.create.l HWIO_MPM2_MPM_TSYNC_START_PHASE_ADDR A:0x604a600c
y.create.l HWIO_MPM2_MPM_TSYNC_PERIOD_ADDR A:0x604a6010
y.create.l HWIO_MPM2_MPM_TSYNC_PERIOD_PHASE_ADDR A:0x604a6014
y.create.l HWIO_MPM2_MPM_TSYNC_STATUS_TIME_ADDR A:0x604a6018
y.create.l HWIO_MPM2_MPM_TSYNC_STATUS_PHASE_ADDR A:0x604a601c
y.create.l HWIO_MPM2_MPM_GRFC_CXO_EN_ADDR A:0x604a6020
y.create.l HWIO_MPM2_XPU_SCR_ADDR A:0x604a7000
y.create.l HWIO_MPM2_XPU_SWDR_ADDR A:0x604a7004
y.create.l HWIO_MPM2_XPU_SEAR0_ADDR A:0x604a7040
y.create.l HWIO_MPM2_XPU_SESR_ADDR A:0x604a7048
y.create.l HWIO_MPM2_XPU_SESRRESTORE_ADDR A:0x604a704c
y.create.l HWIO_MPM2_XPU_SESYNR0_ADDR A:0x604a7050
y.create.l HWIO_MPM2_XPU_SESYNR1_ADDR A:0x604a7054
y.create.l HWIO_MPM2_XPU_SESYNR2_ADDR A:0x604a7058
y.create.l HWIO_MPM2_XPU_MCR_ADDR A:0x604a7100
y.create.l HWIO_MPM2_XPU_MEAR0_ADDR A:0x604a7140
y.create.l HWIO_MPM2_XPU_MESR_ADDR A:0x604a7148
y.create.l HWIO_MPM2_XPU_MESRRESTORE_ADDR A:0x604a714c
y.create.l HWIO_MPM2_XPU_MESYNR0_ADDR A:0x604a7150
y.create.l HWIO_MPM2_XPU_MESYNR1_ADDR A:0x604a7154
y.create.l HWIO_MPM2_XPU_MESYNR2_ADDR A:0x604a7158
y.create.l HWIO_MPM2_XPU_CR_ADDR A:0x604a7080
y.create.l HWIO_MPM2_XPU_RPU_ACR0_ADDR A:0x604a70a0
y.create.l HWIO_MPM2_XPU_EAR0_ADDR A:0x604a70c0
y.create.l HWIO_MPM2_XPU_ESR_ADDR A:0x604a70c8
y.create.l HWIO_MPM2_XPU_ESRRESTORE_ADDR A:0x604a70cc
y.create.l HWIO_MPM2_XPU_ESYNR0_ADDR A:0x604a70d0
y.create.l HWIO_MPM2_XPU_ESYNR1_ADDR A:0x604a70d4
y.create.l HWIO_MPM2_XPU_ESYNR2_ADDR A:0x604a70d8
y.create.l HWIO_MPM2_XPU_IDR0_ADDR A:0x604a7074
y.create.l HWIO_MPM2_XPU_IDR1_ADDR A:0x604a7078
y.create.l HWIO_MPM2_XPU_REV_ADDR A:0x604a707c
y.create.l HWIO_MPM2_XPU_RG0_RACR0_ADDR A:0x604a7200
y.create.l HWIO_MPM2_XPU_RG1_RACR0_ADDR A:0x604a7280
y.create.l HWIO_MPM2_XPU_RG2_RACR0_ADDR A:0x604a7300
y.create.l HWIO_MPM2_XPU_RG3_RACR0_ADDR A:0x604a7380
y.create.l HWIO_MPM2_XPU_RG4_RACR0_ADDR A:0x604a7400
y.create.l HWIO_MPM2_XPU_RG5_RACR0_ADDR A:0x604a7480
y.create.l HWIO_MPM2_XPU_RG6_RACR0_ADDR A:0x604a7500
y.create.l HWIO_MPM2_XPU_RG7_RACR0_ADDR A:0x604a7580
y.create.l HWIO_MPM2_XPU_RG8_RACR0_ADDR A:0x604a7600
y.create.l HWIO_MPM2_XPU_RG9_RACR0_ADDR A:0x604a7680
y.create.l HWIO_MPM2_XPU_RG0_SCR_ADDR A:0x604a7250
y.create.l HWIO_MPM2_XPU_RG1_SCR_ADDR A:0x604a72d0
y.create.l HWIO_MPM2_XPU_RG2_SCR_ADDR A:0x604a7350
y.create.l HWIO_MPM2_XPU_RG3_SCR_ADDR A:0x604a73d0
y.create.l HWIO_MPM2_XPU_RG4_SCR_ADDR A:0x604a7450
y.create.l HWIO_MPM2_XPU_RG5_SCR_ADDR A:0x604a74d0
y.create.l HWIO_MPM2_XPU_RG6_SCR_ADDR A:0x604a7550
y.create.l HWIO_MPM2_XPU_RG7_SCR_ADDR A:0x604a75d0
y.create.l HWIO_MPM2_XPU_RG8_SCR_ADDR A:0x604a7650
y.create.l HWIO_MPM2_XPU_RG9_SCR_ADDR A:0x604a76d0
y.create.l HWIO_MPM2_XPU_RG0_MCR_ADDR A:0x604a7254
y.create.l HWIO_MPM2_XPU_RG1_MCR_ADDR A:0x604a72d4
y.create.l HWIO_MPM2_XPU_RG2_MCR_ADDR A:0x604a7354
y.create.l HWIO_MPM2_XPU_RG3_MCR_ADDR A:0x604a73d4
y.create.l HWIO_MPM2_XPU_RG4_MCR_ADDR A:0x604a7454
y.create.l HWIO_MPM2_XPU_RG5_MCR_ADDR A:0x604a74d4
y.create.l HWIO_MPM2_XPU_RG6_MCR_ADDR A:0x604a7554
y.create.l HWIO_MPM2_XPU_RG7_MCR_ADDR A:0x604a75d4
y.create.l HWIO_MPM2_XPU_RG8_MCR_ADDR A:0x604a7654
y.create.l HWIO_MPM2_XPU_RG9_MCR_ADDR A:0x604a76d4
y.create.l HWIO_MPM2_TSENS_CTRL_ADDR A:0x604a8000
y.create.l HWIO_MPM2_TSENS_TEST_CTRL_ADDR A:0x604a8004
y.create.l HWIO_MPM2_TSENS_S0_MIN_MAX_STATUS_CTRL_ADDR A:0x604a8008
y.create.l HWIO_MPM2_TSENS_S1_MIN_MAX_STATUS_CTRL_ADDR A:0x604a800c
y.create.l HWIO_MPM2_TSENS_S2_MIN_MAX_STATUS_CTRL_ADDR A:0x604a8010
y.create.l HWIO_MPM2_TSENS_S3_MIN_MAX_STATUS_CTRL_ADDR A:0x604a8014
y.create.l HWIO_MPM2_TSENS_S4_MIN_MAX_STATUS_CTRL_ADDR A:0x604a8018
y.create.l HWIO_MPM2_TSENS_S5_MIN_MAX_STATUS_CTRL_ADDR A:0x604a801c
y.create.l HWIO_MPM2_TSENS_S6_MIN_MAX_STATUS_CTRL_ADDR A:0x604a8020
y.create.l HWIO_MPM2_TSENS_S7_MIN_MAX_STATUS_CTRL_ADDR A:0x604a8024
y.create.l HWIO_MPM2_TSENS_S8_MIN_MAX_STATUS_CTRL_ADDR A:0x604a8028
y.create.l HWIO_MPM2_TSENS_S9_MIN_MAX_STATUS_CTRL_ADDR A:0x604a802c
y.create.l HWIO_MPM2_TSENS_GLOBAL_CONFIG_ADDR A:0x604a8034
y.create.l HWIO_MPM2_TSENS_S0_MAIN_CONFIG_ADDR A:0x604a8038
y.create.l HWIO_MPM2_TSENS_S1_REMOTE_CONFIG_ADDR A:0x604a8040
y.create.l HWIO_MPM2_TSENS_S2_REMOTE_CONFIG_ADDR A:0x604a8044
y.create.l HWIO_MPM2_TSENS_S3_REMOTE_CONFIG_ADDR A:0x604a8048
y.create.l HWIO_MPM2_TSENS_S4_REMOTE_CONFIG_ADDR A:0x604a804c
y.create.l HWIO_MPM2_TSENS_S5_REMOTE_CONFIG_ADDR A:0x604a8050
y.create.l HWIO_MPM2_TSENS_S6_REMOTE_CONFIG_ADDR A:0x604a8054
y.create.l HWIO_MPM2_TSENS_S7_REMOTE_CONFIG_ADDR A:0x604a8058
y.create.l HWIO_MPM2_TSENS_S8_REMOTE_CONFIG_ADDR A:0x604a805c
y.create.l HWIO_MPM2_TSENS_S9_REMOTE_CONFIG_ADDR A:0x604a8060
y.create.l HWIO_MPM2_TSENS_S10_REMOTE_CONFIG_ADDR A:0x604a8064
y.create.l HWIO_MPM2_TSENS_UPPER_LOWER_INTERRUPT_CTRL_ADDR A:0x604a9000
y.create.l HWIO_MPM2_TSENS_S0_UPPER_LOWER_STATUS_CTRL_ADDR A:0x604a9004
y.create.l HWIO_MPM2_TSENS_S1_UPPER_LOWER_STATUS_CTRL_ADDR A:0x604a9008
y.create.l HWIO_MPM2_TSENS_S2_UPPER_LOWER_STATUS_CTRL_ADDR A:0x604a900c
y.create.l HWIO_MPM2_TSENS_S3_UPPER_LOWER_STATUS_CTRL_ADDR A:0x604a9010
y.create.l HWIO_MPM2_TSENS_S4_UPPER_LOWER_STATUS_CTRL_ADDR A:0x604a9014
y.create.l HWIO_MPM2_TSENS_S5_UPPER_LOWER_STATUS_CTRL_ADDR A:0x604a9018
y.create.l HWIO_MPM2_TSENS_S6_UPPER_LOWER_STATUS_CTRL_ADDR A:0x604a901c
y.create.l HWIO_MPM2_TSENS_S7_UPPER_LOWER_STATUS_CTRL_ADDR A:0x604a9020
y.create.l HWIO_MPM2_TSENS_S8_UPPER_LOWER_STATUS_CTRL_ADDR A:0x604a9024
y.create.l HWIO_MPM2_TSENS_S9_UPPER_LOWER_STATUS_CTRL_ADDR A:0x604a9028
y.create.l HWIO_MPM2_TSENS_S0_STATUS_ADDR A:0x604a9030
y.create.l HWIO_MPM2_TSENS_S1_STATUS_ADDR A:0x604a9034
y.create.l HWIO_MPM2_TSENS_S2_STATUS_ADDR A:0x604a9038
y.create.l HWIO_MPM2_TSENS_S3_STATUS_ADDR A:0x604a903c
y.create.l HWIO_MPM2_TSENS_S4_STATUS_ADDR A:0x604a9040
y.create.l HWIO_MPM2_TSENS_S5_STATUS_ADDR A:0x604a9044
y.create.l HWIO_MPM2_TSENS_S6_STATUS_ADDR A:0x604a9048
y.create.l HWIO_MPM2_TSENS_S7_STATUS_ADDR A:0x604a904c
y.create.l HWIO_MPM2_TSENS_S8_STATUS_ADDR A:0x604a9050
y.create.l HWIO_MPM2_TSENS_S9_STATUS_ADDR A:0x604a9054
y.create.l HWIO_MPM2_TSENS_TRDY_ADDR A:0x604a905c
y.create.l HWIO_MPM2_WDOG_RESET_REG_ADDR A:0x604aa000
y.create.l HWIO_MPM2_WDOG_CTL_REG_ADDR A:0x604aa004
y.create.l HWIO_MPM2_WDOG_STATUS_REG_ADDR A:0x604aa008
y.create.l HWIO_MPM2_WDOG_BARK_VAL_REG_ADDR A:0x604aa00c
y.create.l HWIO_MPM2_WDOG_BITE_VAL_REG_ADDR A:0x604aa010
y.create.l HWIO_MPM2_MPM_PS_HOLD_ADDR A:0x604ab000
y.create.l HWIO_MPM2_MPM_DDR_PHY_FREEZEIO_EBI1_ADDR A:0x604ab004
y.create.l HWIO_MSS_XPU_SCR_ADDR A:0x64000000
y.create.l HWIO_MSS_XPU_SWDR_ADDR A:0x64000004
y.create.l HWIO_MSS_XPU_SEAR0_ADDR A:0x64000040
y.create.l HWIO_MSS_XPU_SESR_ADDR A:0x64000048
y.create.l HWIO_MSS_XPU_SESRRESTORE_ADDR A:0x6400004c
y.create.l HWIO_MSS_XPU_SESYNR0_ADDR A:0x64000050
y.create.l HWIO_MSS_XPU_SESYNR1_ADDR A:0x64000054
y.create.l HWIO_MSS_XPU_SESYNR2_ADDR A:0x64000058
y.create.l HWIO_MSS_XPU_MCR_ADDR A:0x64000100
y.create.l HWIO_MSS_XPU_MEAR0_ADDR A:0x64000140
y.create.l HWIO_MSS_XPU_MESR_ADDR A:0x64000148
y.create.l HWIO_MSS_XPU_MESRRESTORE_ADDR A:0x6400014c
y.create.l HWIO_MSS_XPU_MESYNR0_ADDR A:0x64000150
y.create.l HWIO_MSS_XPU_MESYNR1_ADDR A:0x64000154
y.create.l HWIO_MSS_XPU_MESYNR2_ADDR A:0x64000158
y.create.l HWIO_MSS_XPU_CR_ADDR A:0x64000080
y.create.l HWIO_MSS_XPU_RPU_ACR0_ADDR A:0x640000a0
y.create.l HWIO_MSS_XPU_EAR0_ADDR A:0x640000c0
y.create.l HWIO_MSS_XPU_ESR_ADDR A:0x640000c8
y.create.l HWIO_MSS_XPU_ESRRESTORE_ADDR A:0x640000cc
y.create.l HWIO_MSS_XPU_ESYNR0_ADDR A:0x640000d0
y.create.l HWIO_MSS_XPU_ESYNR1_ADDR A:0x640000d4
y.create.l HWIO_MSS_XPU_ESYNR2_ADDR A:0x640000d8
y.create.l HWIO_MSS_XPU_IDR0_ADDR A:0x64000074
y.create.l HWIO_MSS_XPU_IDR1_ADDR A:0x64000078
y.create.l HWIO_MSS_XPU_REV_ADDR A:0x6400007c
y.create.l HWIO_MSS_XPU_RG0_RACR0_ADDR A:0x64000200
y.create.l HWIO_MSS_XPU_RG1_RACR0_ADDR A:0x64000280
y.create.l HWIO_MSS_XPU_RG2_RACR0_ADDR A:0x64000300
y.create.l HWIO_MSS_XPU_RG3_RACR0_ADDR A:0x64000380
y.create.l HWIO_MSS_XPU_RG4_RACR0_ADDR A:0x64000400
y.create.l HWIO_MSS_XPU_RG0_SCR_ADDR A:0x64000250
y.create.l HWIO_MSS_XPU_RG1_SCR_ADDR A:0x640002d0
y.create.l HWIO_MSS_XPU_RG2_SCR_ADDR A:0x64000350
y.create.l HWIO_MSS_XPU_RG3_SCR_ADDR A:0x640003d0
y.create.l HWIO_MSS_XPU_RG4_SCR_ADDR A:0x64000450
y.create.l HWIO_MSS_XPU_RG0_MCR_ADDR A:0x64000254
y.create.l HWIO_MSS_XPU_RG1_MCR_ADDR A:0x640002d4
y.create.l HWIO_MSS_XPU_RG2_MCR_ADDR A:0x64000354
y.create.l HWIO_MSS_XPU_RG3_MCR_ADDR A:0x640003d4
y.create.l HWIO_MSS_XPU_RG4_MCR_ADDR A:0x64000454
y.create.l HWIO_MSS_RELAY_MSG_BUFFER_00_ADDR A:0x64020000
y.create.l HWIO_MSS_RELAY_MSG_BUFFER_01_ADDR A:0x64020004
y.create.l HWIO_MSS_RELAY_MSG_BUFFER_02_ADDR A:0x64020008
y.create.l HWIO_MSS_RELAY_MSG_BUFFER_03_ADDR A:0x6402000c
y.create.l HWIO_MSS_RELAY_MSG_BUFFER_04_ADDR A:0x64020010
y.create.l HWIO_MSS_RELAY_MSG_BUFFER_05_ADDR A:0x64020014
y.create.l HWIO_MSS_RELAY_MSG_BUFFER_06_ADDR A:0x64020018
y.create.l HWIO_MSS_RELAY_MSG_BUFFER_07_ADDR A:0x6402001c
y.create.l HWIO_MSS_RELAY_MSG_BUFFER_08_ADDR A:0x64020020
y.create.l HWIO_MSS_RELAY_MSG_BUFFER_09_ADDR A:0x64020024
y.create.l HWIO_MSS_RELAY_MSG_BUFFER_10_ADDR A:0x64020028
y.create.l HWIO_MSS_RELAY_MSG_BUFFER_11_ADDR A:0x6402002c
y.create.l HWIO_MSS_RELAY_MSG_BUFFER_12_ADDR A:0x64020030
y.create.l HWIO_MSS_RELAY_MSG_BUFFER_13_ADDR A:0x64020034
y.create.l HWIO_MSS_RELAY_MSG_BUFFER_14_ADDR A:0x64020038
y.create.l HWIO_MSS_RELAY_MSG_BUFFER_15_ADDR A:0x6402003c
y.create.l HWIO_MSS_BAM_CTRL_ADDR A:0x64044000
y.create.l HWIO_MSS_BAM_TIMER_ADDR A:0x64044040
y.create.l HWIO_MSS_BAM_TIMER_CTRL_ADDR A:0x64044044
y.create.l HWIO_MSS_BAM_DESC_CNT_TRSHLD_ADDR A:0x64044008
y.create.l HWIO_MSS_BAM_IRQ_STTS_ADDR A:0x64044014
y.create.l HWIO_MSS_BAM_IRQ_CLR_ADDR A:0x64044018
y.create.l HWIO_MSS_BAM_IRQ_EN_ADDR A:0x6404401c
y.create.l HWIO_MSS_BAM_CNFG_BITS_ADDR A:0x6404407c
y.create.l HWIO_MSS_BAM_REVISION_ADDR A:0x64045000
y.create.l HWIO_MSS_BAM_SW_VERSION_ADDR A:0x64045004
y.create.l HWIO_MSS_BAM_NUM_PIPES_ADDR A:0x64045008
y.create.l HWIO_MSS_BAM_TEST_BUS_SEL_ADDR A:0x64045010
y.create.l HWIO_MSS_BAM_TEST_BUS_REG_ADDR A:0x64045014
y.create.l HWIO_MSS_BAM_AHB_MASTER_ERR_CTRLS_ADDR A:0x64045024
y.create.l HWIO_MSS_BAM_AHB_MASTER_ERR_ADDR_ADDR A:0x64045028
y.create.l HWIO_MSS_BAM_AHB_MASTER_ERR_DATA_ADDR A:0x6404502c
y.create.l HWIO_MSS_BAM_AHB_MASTER_ERR_ADDR_LSB_ADDR A:0x64045100
y.create.l HWIO_MSS_BAM_AHB_MASTER_ERR_ADDR_MSB_ADDR A:0x64045104
y.create.l HWIO_MSS_BAM_TRUST_REG_ADDR A:0x64046000
y.create.l HWIO_MSS_BAM_P_TRUST_REG0_ADDR A:0x64046020
y.create.l HWIO_MSS_BAM_P_TRUST_REG1_ADDR A:0x64046024
y.create.l HWIO_MSS_BAM_P_TRUST_REG2_ADDR A:0x64046028
y.create.l HWIO_MSS_BAM_P_TRUST_REG3_ADDR A:0x6404602c
y.create.l HWIO_MSS_BAM_P_TRUST_REG4_ADDR A:0x64046030
y.create.l HWIO_MSS_BAM_P_TRUST_REG5_ADDR A:0x64046034
y.create.l HWIO_MSS_BAM_IRQ_SRCS_EE0_ADDR A:0x64047000
y.create.l HWIO_MSS_BAM_IRQ_SRCS_EE1_ADDR A:0x64048000
y.create.l HWIO_MSS_BAM_IRQ_SRCS_EE2_ADDR A:0x64049000
y.create.l HWIO_MSS_BAM_IRQ_SRCS_EE3_ADDR A:0x6404a000
y.create.l HWIO_MSS_BAM_IRQ_SRCS_EE4_ADDR A:0x6404b000
y.create.l HWIO_MSS_BAM_IRQ_SRCS_EE5_ADDR A:0x6404c000
y.create.l HWIO_MSS_BAM_IRQ_SRCS_EE6_ADDR A:0x6404d000
y.create.l HWIO_MSS_BAM_IRQ_SRCS_EE7_ADDR A:0x6404e000
y.create.l HWIO_MSS_BAM_IRQ_SRCS_MSK_EE0_ADDR A:0x64047004
y.create.l HWIO_MSS_BAM_IRQ_SRCS_MSK_EE1_ADDR A:0x64048004
y.create.l HWIO_MSS_BAM_IRQ_SRCS_MSK_EE2_ADDR A:0x64049004
y.create.l HWIO_MSS_BAM_IRQ_SRCS_MSK_EE3_ADDR A:0x6404a004
y.create.l HWIO_MSS_BAM_IRQ_SRCS_MSK_EE4_ADDR A:0x6404b004
y.create.l HWIO_MSS_BAM_IRQ_SRCS_MSK_EE5_ADDR A:0x6404c004
y.create.l HWIO_MSS_BAM_IRQ_SRCS_MSK_EE6_ADDR A:0x6404d004
y.create.l HWIO_MSS_BAM_IRQ_SRCS_MSK_EE7_ADDR A:0x6404e004
y.create.l HWIO_MSS_BAM_IRQ_SRCS_UNMASKED_EE0_ADDR A:0x64047008
y.create.l HWIO_MSS_BAM_IRQ_SRCS_UNMASKED_EE1_ADDR A:0x64048008
y.create.l HWIO_MSS_BAM_IRQ_SRCS_UNMASKED_EE2_ADDR A:0x64049008
y.create.l HWIO_MSS_BAM_IRQ_SRCS_UNMASKED_EE3_ADDR A:0x6404a008
y.create.l HWIO_MSS_BAM_IRQ_SRCS_UNMASKED_EE4_ADDR A:0x6404b008
y.create.l HWIO_MSS_BAM_IRQ_SRCS_UNMASKED_EE5_ADDR A:0x6404c008
y.create.l HWIO_MSS_BAM_IRQ_SRCS_UNMASKED_EE6_ADDR A:0x6404d008
y.create.l HWIO_MSS_BAM_IRQ_SRCS_UNMASKED_EE7_ADDR A:0x6404e008
y.create.l HWIO_MSS_BAM_PIPE_ATTR_EE0_ADDR A:0x6404700c
y.create.l HWIO_MSS_BAM_PIPE_ATTR_EE1_ADDR A:0x6404800c
y.create.l HWIO_MSS_BAM_PIPE_ATTR_EE2_ADDR A:0x6404900c
y.create.l HWIO_MSS_BAM_PIPE_ATTR_EE3_ADDR A:0x6404a00c
y.create.l HWIO_MSS_BAM_PIPE_ATTR_EE4_ADDR A:0x6404b00c
y.create.l HWIO_MSS_BAM_PIPE_ATTR_EE5_ADDR A:0x6404c00c
y.create.l HWIO_MSS_BAM_PIPE_ATTR_EE6_ADDR A:0x6404d00c
y.create.l HWIO_MSS_BAM_PIPE_ATTR_EE7_ADDR A:0x6404e00c
y.create.l HWIO_MSS_BAM_IRQ_SRCS_ADDR A:0x64047010
y.create.l HWIO_MSS_BAM_IRQ_SRCS_MSK_ADDR A:0x64047014
y.create.l HWIO_MSS_BAM_IRQ_SRCS_UNMASKED_ADDR A:0x64047018
y.create.l HWIO_MSS_BAM_P_CTRL0_ADDR A:0x64057000
y.create.l HWIO_MSS_BAM_P_CTRL1_ADDR A:0x64058000
y.create.l HWIO_MSS_BAM_P_CTRL2_ADDR A:0x64059000
y.create.l HWIO_MSS_BAM_P_CTRL3_ADDR A:0x6405a000
y.create.l HWIO_MSS_BAM_P_CTRL4_ADDR A:0x6405b000
y.create.l HWIO_MSS_BAM_P_CTRL5_ADDR A:0x6405c000
y.create.l HWIO_MSS_BAM_P_RST0_ADDR A:0x64057004
y.create.l HWIO_MSS_BAM_P_RST1_ADDR A:0x64058004
y.create.l HWIO_MSS_BAM_P_RST2_ADDR A:0x64059004
y.create.l HWIO_MSS_BAM_P_RST3_ADDR A:0x6405a004
y.create.l HWIO_MSS_BAM_P_RST4_ADDR A:0x6405b004
y.create.l HWIO_MSS_BAM_P_RST5_ADDR A:0x6405c004
y.create.l HWIO_MSS_BAM_P_HALT0_ADDR A:0x64057008
y.create.l HWIO_MSS_BAM_P_HALT1_ADDR A:0x64058008
y.create.l HWIO_MSS_BAM_P_HALT2_ADDR A:0x64059008
y.create.l HWIO_MSS_BAM_P_HALT3_ADDR A:0x6405a008
y.create.l HWIO_MSS_BAM_P_HALT4_ADDR A:0x6405b008
y.create.l HWIO_MSS_BAM_P_HALT5_ADDR A:0x6405c008
y.create.l HWIO_MSS_BAM_P_IRQ_STTS0_ADDR A:0x64057010
y.create.l HWIO_MSS_BAM_P_IRQ_STTS1_ADDR A:0x64058010
y.create.l HWIO_MSS_BAM_P_IRQ_STTS2_ADDR A:0x64059010
y.create.l HWIO_MSS_BAM_P_IRQ_STTS3_ADDR A:0x6405a010
y.create.l HWIO_MSS_BAM_P_IRQ_STTS4_ADDR A:0x6405b010
y.create.l HWIO_MSS_BAM_P_IRQ_STTS5_ADDR A:0x6405c010
y.create.l HWIO_MSS_BAM_P_IRQ_CLR0_ADDR A:0x64057014
y.create.l HWIO_MSS_BAM_P_IRQ_CLR1_ADDR A:0x64058014
y.create.l HWIO_MSS_BAM_P_IRQ_CLR2_ADDR A:0x64059014
y.create.l HWIO_MSS_BAM_P_IRQ_CLR3_ADDR A:0x6405a014
y.create.l HWIO_MSS_BAM_P_IRQ_CLR4_ADDR A:0x6405b014
y.create.l HWIO_MSS_BAM_P_IRQ_CLR5_ADDR A:0x6405c014
y.create.l HWIO_MSS_BAM_P_IRQ_EN0_ADDR A:0x64057018
y.create.l HWIO_MSS_BAM_P_IRQ_EN1_ADDR A:0x64058018
y.create.l HWIO_MSS_BAM_P_IRQ_EN2_ADDR A:0x64059018
y.create.l HWIO_MSS_BAM_P_IRQ_EN3_ADDR A:0x6405a018
y.create.l HWIO_MSS_BAM_P_IRQ_EN4_ADDR A:0x6405b018
y.create.l HWIO_MSS_BAM_P_IRQ_EN5_ADDR A:0x6405c018
y.create.l HWIO_MSS_BAM_P_TIMER0_ADDR A:0x6405701c
y.create.l HWIO_MSS_BAM_P_TIMER1_ADDR A:0x6405801c
y.create.l HWIO_MSS_BAM_P_TIMER2_ADDR A:0x6405901c
y.create.l HWIO_MSS_BAM_P_TIMER3_ADDR A:0x6405a01c
y.create.l HWIO_MSS_BAM_P_TIMER4_ADDR A:0x6405b01c
y.create.l HWIO_MSS_BAM_P_TIMER5_ADDR A:0x6405c01c
y.create.l HWIO_MSS_BAM_P_TIMER_CTRL0_ADDR A:0x64057020
y.create.l HWIO_MSS_BAM_P_TIMER_CTRL1_ADDR A:0x64058020
y.create.l HWIO_MSS_BAM_P_TIMER_CTRL2_ADDR A:0x64059020
y.create.l HWIO_MSS_BAM_P_TIMER_CTRL3_ADDR A:0x6405a020
y.create.l HWIO_MSS_BAM_P_TIMER_CTRL4_ADDR A:0x6405b020
y.create.l HWIO_MSS_BAM_P_TIMER_CTRL5_ADDR A:0x6405c020
y.create.l HWIO_MSS_BAM_P_PRDCR_SDBND0_ADDR A:0x64057024
y.create.l HWIO_MSS_BAM_P_PRDCR_SDBND1_ADDR A:0x64058024
y.create.l HWIO_MSS_BAM_P_PRDCR_SDBND2_ADDR A:0x64059024
y.create.l HWIO_MSS_BAM_P_PRDCR_SDBND3_ADDR A:0x6405a024
y.create.l HWIO_MSS_BAM_P_PRDCR_SDBND4_ADDR A:0x6405b024
y.create.l HWIO_MSS_BAM_P_PRDCR_SDBND5_ADDR A:0x6405c024
y.create.l HWIO_MSS_BAM_P_CNSMR_SDBND0_ADDR A:0x64057028
y.create.l HWIO_MSS_BAM_P_CNSMR_SDBND1_ADDR A:0x64058028
y.create.l HWIO_MSS_BAM_P_CNSMR_SDBND2_ADDR A:0x64059028
y.create.l HWIO_MSS_BAM_P_CNSMR_SDBND3_ADDR A:0x6405a028
y.create.l HWIO_MSS_BAM_P_CNSMR_SDBND4_ADDR A:0x6405b028
y.create.l HWIO_MSS_BAM_P_CNSMR_SDBND5_ADDR A:0x6405c028
y.create.l HWIO_MSS_BAM_P_SW_OFSTS0_ADDR A:0x64057800
y.create.l HWIO_MSS_BAM_P_SW_OFSTS1_ADDR A:0x64058800
y.create.l HWIO_MSS_BAM_P_SW_OFSTS2_ADDR A:0x64059800
y.create.l HWIO_MSS_BAM_P_SW_OFSTS3_ADDR A:0x6405a800
y.create.l HWIO_MSS_BAM_P_SW_OFSTS4_ADDR A:0x6405b800
y.create.l HWIO_MSS_BAM_P_SW_OFSTS5_ADDR A:0x6405c800
y.create.l HWIO_MSS_BAM_P_AU_PSM_CNTXT_1_0_ADDR A:0x64057804
y.create.l HWIO_MSS_BAM_P_AU_PSM_CNTXT_1_1_ADDR A:0x64058804
y.create.l HWIO_MSS_BAM_P_AU_PSM_CNTXT_1_2_ADDR A:0x64059804
y.create.l HWIO_MSS_BAM_P_AU_PSM_CNTXT_1_3_ADDR A:0x6405a804
y.create.l HWIO_MSS_BAM_P_AU_PSM_CNTXT_1_4_ADDR A:0x6405b804
y.create.l HWIO_MSS_BAM_P_AU_PSM_CNTXT_1_5_ADDR A:0x6405c804
y.create.l HWIO_MSS_BAM_P_PSM_CNTXT_2_0_ADDR A:0x64057808
y.create.l HWIO_MSS_BAM_P_PSM_CNTXT_2_1_ADDR A:0x64058808
y.create.l HWIO_MSS_BAM_P_PSM_CNTXT_2_2_ADDR A:0x64059808
y.create.l HWIO_MSS_BAM_P_PSM_CNTXT_2_3_ADDR A:0x6405a808
y.create.l HWIO_MSS_BAM_P_PSM_CNTXT_2_4_ADDR A:0x6405b808
y.create.l HWIO_MSS_BAM_P_PSM_CNTXT_2_5_ADDR A:0x6405c808
y.create.l HWIO_MSS_BAM_P_PSM_CNTXT_3_0_ADDR A:0x6405780c
y.create.l HWIO_MSS_BAM_P_PSM_CNTXT_3_1_ADDR A:0x6405880c
y.create.l HWIO_MSS_BAM_P_PSM_CNTXT_3_2_ADDR A:0x6405980c
y.create.l HWIO_MSS_BAM_P_PSM_CNTXT_3_3_ADDR A:0x6405a80c
y.create.l HWIO_MSS_BAM_P_PSM_CNTXT_3_4_ADDR A:0x6405b80c
y.create.l HWIO_MSS_BAM_P_PSM_CNTXT_3_5_ADDR A:0x6405c80c
y.create.l HWIO_MSS_BAM_P_PSM_CNTXT_4_0_ADDR A:0x64057810
y.create.l HWIO_MSS_BAM_P_PSM_CNTXT_4_1_ADDR A:0x64058810
y.create.l HWIO_MSS_BAM_P_PSM_CNTXT_4_2_ADDR A:0x64059810
y.create.l HWIO_MSS_BAM_P_PSM_CNTXT_4_3_ADDR A:0x6405a810
y.create.l HWIO_MSS_BAM_P_PSM_CNTXT_4_4_ADDR A:0x6405b810
y.create.l HWIO_MSS_BAM_P_PSM_CNTXT_4_5_ADDR A:0x6405c810
y.create.l HWIO_MSS_BAM_P_PSM_CNTXT_5_0_ADDR A:0x64057814
y.create.l HWIO_MSS_BAM_P_PSM_CNTXT_5_1_ADDR A:0x64058814
y.create.l HWIO_MSS_BAM_P_PSM_CNTXT_5_2_ADDR A:0x64059814
y.create.l HWIO_MSS_BAM_P_PSM_CNTXT_5_3_ADDR A:0x6405a814
y.create.l HWIO_MSS_BAM_P_PSM_CNTXT_5_4_ADDR A:0x6405b814
y.create.l HWIO_MSS_BAM_P_PSM_CNTXT_5_5_ADDR A:0x6405c814
y.create.l HWIO_MSS_BAM_P_EVNT_REG0_ADDR A:0x64057818
y.create.l HWIO_MSS_BAM_P_EVNT_REG1_ADDR A:0x64058818
y.create.l HWIO_MSS_BAM_P_EVNT_REG2_ADDR A:0x64059818
y.create.l HWIO_MSS_BAM_P_EVNT_REG3_ADDR A:0x6405a818
y.create.l HWIO_MSS_BAM_P_EVNT_REG4_ADDR A:0x6405b818
y.create.l HWIO_MSS_BAM_P_EVNT_REG5_ADDR A:0x6405c818
y.create.l HWIO_MSS_BAM_P_DESC_FIFO_ADDR0_ADDR A:0x6405781c
y.create.l HWIO_MSS_BAM_P_DESC_FIFO_ADDR1_ADDR A:0x6405881c
y.create.l HWIO_MSS_BAM_P_DESC_FIFO_ADDR2_ADDR A:0x6405981c
y.create.l HWIO_MSS_BAM_P_DESC_FIFO_ADDR3_ADDR A:0x6405a81c
y.create.l HWIO_MSS_BAM_P_DESC_FIFO_ADDR4_ADDR A:0x6405b81c
y.create.l HWIO_MSS_BAM_P_DESC_FIFO_ADDR5_ADDR A:0x6405c81c
y.create.l HWIO_MSS_BAM_P_FIFO_SIZES0_ADDR A:0x64057820
y.create.l HWIO_MSS_BAM_P_FIFO_SIZES1_ADDR A:0x64058820
y.create.l HWIO_MSS_BAM_P_FIFO_SIZES2_ADDR A:0x64059820
y.create.l HWIO_MSS_BAM_P_FIFO_SIZES3_ADDR A:0x6405a820
y.create.l HWIO_MSS_BAM_P_FIFO_SIZES4_ADDR A:0x6405b820
y.create.l HWIO_MSS_BAM_P_FIFO_SIZES5_ADDR A:0x6405c820
y.create.l HWIO_MSS_BAM_P_DATA_FIFO_ADDR0_ADDR A:0x64057824
y.create.l HWIO_MSS_BAM_P_DATA_FIFO_ADDR1_ADDR A:0x64058824
y.create.l HWIO_MSS_BAM_P_DATA_FIFO_ADDR2_ADDR A:0x64059824
y.create.l HWIO_MSS_BAM_P_DATA_FIFO_ADDR3_ADDR A:0x6405a824
y.create.l HWIO_MSS_BAM_P_DATA_FIFO_ADDR4_ADDR A:0x6405b824
y.create.l HWIO_MSS_BAM_P_DATA_FIFO_ADDR5_ADDR A:0x6405c824
y.create.l HWIO_MSS_BAM_P_EVNT_GEN_TRSHLD0_ADDR A:0x64057828
y.create.l HWIO_MSS_BAM_P_EVNT_GEN_TRSHLD1_ADDR A:0x64058828
y.create.l HWIO_MSS_BAM_P_EVNT_GEN_TRSHLD2_ADDR A:0x64059828
y.create.l HWIO_MSS_BAM_P_EVNT_GEN_TRSHLD3_ADDR A:0x6405a828
y.create.l HWIO_MSS_BAM_P_EVNT_GEN_TRSHLD4_ADDR A:0x6405b828
y.create.l HWIO_MSS_BAM_P_EVNT_GEN_TRSHLD5_ADDR A:0x6405c828
y.create.l HWIO_MSS_BAM_P_EVNT_DEST_ADDR0_ADDR A:0x6405782c
y.create.l HWIO_MSS_BAM_P_EVNT_DEST_ADDR1_ADDR A:0x6405882c
y.create.l HWIO_MSS_BAM_P_EVNT_DEST_ADDR2_ADDR A:0x6405982c
y.create.l HWIO_MSS_BAM_P_EVNT_DEST_ADDR3_ADDR A:0x6405a82c
y.create.l HWIO_MSS_BAM_P_EVNT_DEST_ADDR4_ADDR A:0x6405b82c
y.create.l HWIO_MSS_BAM_P_EVNT_DEST_ADDR5_ADDR A:0x6405c82c
y.create.l HWIO_MSS_BAM_P_DF_CNTXT_0_ADDR A:0x64057830
y.create.l HWIO_MSS_BAM_P_DF_CNTXT_1_ADDR A:0x64058830
y.create.l HWIO_MSS_BAM_P_DF_CNTXT_2_ADDR A:0x64059830
y.create.l HWIO_MSS_BAM_P_DF_CNTXT_3_ADDR A:0x6405a830
y.create.l HWIO_MSS_BAM_P_DF_CNTXT_4_ADDR A:0x6405b830
y.create.l HWIO_MSS_BAM_P_DF_CNTXT_5_ADDR A:0x6405c830
y.create.l HWIO_MSS_BAM_P_RETR_CNTXT_0_ADDR A:0x64057834
y.create.l HWIO_MSS_BAM_P_RETR_CNTXT_1_ADDR A:0x64058834
y.create.l HWIO_MSS_BAM_P_RETR_CNTXT_2_ADDR A:0x64059834
y.create.l HWIO_MSS_BAM_P_RETR_CNTXT_3_ADDR A:0x6405a834
y.create.l HWIO_MSS_BAM_P_RETR_CNTXT_4_ADDR A:0x6405b834
y.create.l HWIO_MSS_BAM_P_RETR_CNTXT_5_ADDR A:0x6405c834
y.create.l HWIO_MSS_BAM_P_SI_CNTXT_0_ADDR A:0x64057838
y.create.l HWIO_MSS_BAM_P_SI_CNTXT_1_ADDR A:0x64058838
y.create.l HWIO_MSS_BAM_P_SI_CNTXT_2_ADDR A:0x64059838
y.create.l HWIO_MSS_BAM_P_SI_CNTXT_3_ADDR A:0x6405a838
y.create.l HWIO_MSS_BAM_P_SI_CNTXT_4_ADDR A:0x6405b838
y.create.l HWIO_MSS_BAM_P_SI_CNTXT_5_ADDR A:0x6405c838
y.create.l HWIO_MSS_BAM_P_PSM_CNTXT_3_LSB0_ADDR A:0x64057900
y.create.l HWIO_MSS_BAM_P_PSM_CNTXT_3_LSB1_ADDR A:0x64058900
y.create.l HWIO_MSS_BAM_P_PSM_CNTXT_3_LSB2_ADDR A:0x64059900
y.create.l HWIO_MSS_BAM_P_PSM_CNTXT_3_LSB3_ADDR A:0x6405a900
y.create.l HWIO_MSS_BAM_P_PSM_CNTXT_3_LSB4_ADDR A:0x6405b900
y.create.l HWIO_MSS_BAM_P_PSM_CNTXT_3_LSB5_ADDR A:0x6405c900
y.create.l HWIO_MSS_BAM_P_PSM_CNTXT_3_MSB0_ADDR A:0x64057904
y.create.l HWIO_MSS_BAM_P_PSM_CNTXT_3_MSB1_ADDR A:0x64058904
y.create.l HWIO_MSS_BAM_P_PSM_CNTXT_3_MSB2_ADDR A:0x64059904
y.create.l HWIO_MSS_BAM_P_PSM_CNTXT_3_MSB3_ADDR A:0x6405a904
y.create.l HWIO_MSS_BAM_P_PSM_CNTXT_3_MSB4_ADDR A:0x6405b904
y.create.l HWIO_MSS_BAM_P_PSM_CNTXT_3_MSB5_ADDR A:0x6405c904
y.create.l HWIO_MSS_BAM_P_DESC_FIFO_ADDR_LSB0_ADDR A:0x64057910
y.create.l HWIO_MSS_BAM_P_DESC_FIFO_ADDR_LSB1_ADDR A:0x64058910
y.create.l HWIO_MSS_BAM_P_DESC_FIFO_ADDR_LSB2_ADDR A:0x64059910
y.create.l HWIO_MSS_BAM_P_DESC_FIFO_ADDR_LSB3_ADDR A:0x6405a910
y.create.l HWIO_MSS_BAM_P_DESC_FIFO_ADDR_LSB4_ADDR A:0x6405b910
y.create.l HWIO_MSS_BAM_P_DESC_FIFO_ADDR_LSB5_ADDR A:0x6405c910
y.create.l HWIO_MSS_BAM_P_DESC_FIFO_ADDR_MSB0_ADDR A:0x64057914
y.create.l HWIO_MSS_BAM_P_DESC_FIFO_ADDR_MSB1_ADDR A:0x64058914
y.create.l HWIO_MSS_BAM_P_DESC_FIFO_ADDR_MSB2_ADDR A:0x64059914
y.create.l HWIO_MSS_BAM_P_DESC_FIFO_ADDR_MSB3_ADDR A:0x6405a914
y.create.l HWIO_MSS_BAM_P_DESC_FIFO_ADDR_MSB4_ADDR A:0x6405b914
y.create.l HWIO_MSS_BAM_P_DESC_FIFO_ADDR_MSB5_ADDR A:0x6405c914
y.create.l HWIO_MSS_BAM_P_DATA_FIFO_ADDR_LSB0_ADDR A:0x64057920
y.create.l HWIO_MSS_BAM_P_DATA_FIFO_ADDR_LSB1_ADDR A:0x64058920
y.create.l HWIO_MSS_BAM_P_DATA_FIFO_ADDR_LSB2_ADDR A:0x64059920
y.create.l HWIO_MSS_BAM_P_DATA_FIFO_ADDR_LSB3_ADDR A:0x6405a920
y.create.l HWIO_MSS_BAM_P_DATA_FIFO_ADDR_LSB4_ADDR A:0x6405b920
y.create.l HWIO_MSS_BAM_P_DATA_FIFO_ADDR_LSB5_ADDR A:0x6405c920
y.create.l HWIO_MSS_BAM_P_DATA_FIFO_ADDR_MSB0_ADDR A:0x64057924
y.create.l HWIO_MSS_BAM_P_DATA_FIFO_ADDR_MSB1_ADDR A:0x64058924
y.create.l HWIO_MSS_BAM_P_DATA_FIFO_ADDR_MSB2_ADDR A:0x64059924
y.create.l HWIO_MSS_BAM_P_DATA_FIFO_ADDR_MSB3_ADDR A:0x6405a924
y.create.l HWIO_MSS_BAM_P_DATA_FIFO_ADDR_MSB4_ADDR A:0x6405b924
y.create.l HWIO_MSS_BAM_P_DATA_FIFO_ADDR_MSB5_ADDR A:0x6405c924
y.create.l HWIO_MSS_BAM_P_EVNT_DEST_ADDR_LSB0_ADDR A:0x64057930
y.create.l HWIO_MSS_BAM_P_EVNT_DEST_ADDR_LSB1_ADDR A:0x64058930
y.create.l HWIO_MSS_BAM_P_EVNT_DEST_ADDR_LSB2_ADDR A:0x64059930
y.create.l HWIO_MSS_BAM_P_EVNT_DEST_ADDR_LSB3_ADDR A:0x6405a930
y.create.l HWIO_MSS_BAM_P_EVNT_DEST_ADDR_LSB4_ADDR A:0x6405b930
y.create.l HWIO_MSS_BAM_P_EVNT_DEST_ADDR_LSB5_ADDR A:0x6405c930
y.create.l HWIO_MSS_BAM_P_EVNT_DEST_ADDR_MSB0_ADDR A:0x64057934
y.create.l HWIO_MSS_BAM_P_EVNT_DEST_ADDR_MSB1_ADDR A:0x64058934
y.create.l HWIO_MSS_BAM_P_EVNT_DEST_ADDR_MSB2_ADDR A:0x64059934
y.create.l HWIO_MSS_BAM_P_EVNT_DEST_ADDR_MSB3_ADDR A:0x6405a934
y.create.l HWIO_MSS_BAM_P_EVNT_DEST_ADDR_MSB4_ADDR A:0x6405b934
y.create.l HWIO_MSS_BAM_P_EVNT_DEST_ADDR_MSB5_ADDR A:0x6405c934
y.create.l HWIO_MSS_QDSP6SS_VERSION_ADDR A:0x64080000
y.create.l HWIO_MSS_QDSP6SS_CONFIG_ID_ADDR A:0x64080004
y.create.l HWIO_MSS_QDSP6SS_RST_EVB_ADDR A:0x64080010
y.create.l HWIO_MSS_QDSP6SS_RESET_ADDR A:0x64080014
y.create.l HWIO_MSS_QDSP6SS_DBG_CFG_ADDR A:0x64080018
y.create.l HWIO_MSS_QDSP6SS_RET_CFG_ADDR A:0x6408001c
y.create.l HWIO_MSS_QDSP6SS_GFMUX_CTL_ADDR A:0x64080020
y.create.l HWIO_MSS_QDSP6SS_GFMUX_STATUS_ADDR A:0x64080024
y.create.l HWIO_MSS_QDSP6SS_CORE_CMD_RCGR_ADDR A:0x64080028
y.create.l HWIO_MSS_QDSP6SS_CORE_CFG_RCGR_ADDR A:0x6408002c
y.create.l HWIO_MSS_QDSP6SS_PWR_CTL_ADDR A:0x64080030
y.create.l HWIO_MSS_QDSP6SS_CGC_OVERRIDE_ADDR A:0x64080034
y.create.l HWIO_MSS_QDSP6SS_XO_CBCR_ADDR A:0x64080038
y.create.l HWIO_MSS_QDSP6SS_SLEEP_CBCR_ADDR A:0x6408003c
y.create.l HWIO_MSS_QDSP6SS_NMI_ADDR A:0x64080040
y.create.l HWIO_MSS_QDSP6SS_NMI_STATUS_ADDR A:0x64080044
y.create.l HWIO_MSS_QDSP6SS_CLOCK_SPDM_MON_ADDR A:0x64080048
y.create.l HWIO_MSS_QDSP6SS_STATERET_CTL_ADDR A:0x6408004c
y.create.l HWIO_MSS_QDSP6SS_LDO_CFG0_ADDR A:0x64080050
y.create.l HWIO_MSS_QDSP6SS_LDO_CFG1_ADDR A:0x64080054
y.create.l HWIO_MSS_QDSP6SS_LDO_CFG2_ADDR A:0x64080058
y.create.l HWIO_MSS_QDSP6SS_LDO_VREF_SET_ADDR A:0x6408005c
y.create.l HWIO_MSS_QDSP6SS_LDO_VREF_TEST_CFG_ADDR A:0x64080060
y.create.l HWIO_MSS_QDSP6SS_LDO_VREF_CMD_ADDR A:0x64080064
y.create.l HWIO_MSS_QDSP6SS_QMC_SVS_CTL_ADDR A:0x64080068
y.create.l HWIO_MSS_QDSP6SS_BHS_STATUS_ADDR A:0x6408006c
y.create.l HWIO_MSS_QDSP6SS_LDO_EFUSE_STATUS_ADDR A:0x64080070
y.create.l HWIO_MSS_QDSP6SS_BHS_CTL_ADDR A:0x64080074
y.create.l HWIO_MSS_QDSP6SS_SPM_SW_TRIG_ADDR A:0x64080080
y.create.l HWIO_MSS_QDSP6SS_SPM_TRIG_STATUS_ADDR A:0x64080084
y.create.l HWIO_MSS_QDSP6SS_INTF_HALTREQ_ADDR A:0x64080088
y.create.l HWIO_MSS_QDSP6SS_INTF_HALTACK_ADDR A:0x6408008c
y.create.l HWIO_MSS_QDSP6SS_INTFCLAMP_SET_ADDR A:0x64080090
y.create.l HWIO_MSS_QDSP6SS_INTFCLAMP_CLEAR_ADDR A:0x64080094
y.create.l HWIO_MSS_QDSP6SS_INTFCLAMP_STATUS_ADDR A:0x64080098
y.create.l HWIO_MSS_QDSP6SS_INTF_FIFO_RESET_ADDR A:0x640800a0
y.create.l HWIO_MSS_QDSP6SS_CP_PWR_CTL_ADDR A:0x640800f0
y.create.l HWIO_MSS_QDSP6SS_CP_PWR_STATUS_ADDR A:0x640800f4
y.create.l HWIO_MSS_QDSP6SS_CP_RESET_ADDR A:0x640800f8
y.create.l HWIO_MSS_QDSP6SS_STRAP_TCM_ADDR A:0x64080100
y.create.l HWIO_MSS_QDSP6SS_STRAP_AHBUPPER_ADDR A:0x64080104
y.create.l HWIO_MSS_QDSP6SS_STRAP_AHBLOWER_ADDR A:0x64080108
y.create.l HWIO_MSS_QDSP6SS_STRAP_ACC_ADDR A:0x64080110
y.create.l HWIO_MSS_QDSP6SS_STRAP_QMC_ACC_ADDR A:0x64080114
y.create.l HWIO_MSS_QDSP6SS_DCC_CTRL_ADDR A:0x64080118
y.create.l HWIO_MSS_QDSP6SS_STRAP_AXIM2UPPER_ADDR A:0x6408011c
y.create.l HWIO_MSS_QDSP6SS_STRAP_AXIM2LOWER_ADDR A:0x64080120
y.create.l HWIO_MSS_QDSP6SS_PLL_MODE_ADDR A:0x64080200
y.create.l HWIO_MSS_QDSP6SS_PLL_L_VAL_ADDR A:0x64080204
y.create.l HWIO_MSS_QDSP6SS_PLL_ALPHA_VAL_ADDR A:0x64080208
y.create.l HWIO_MSS_QDSP6SS_PLL_ALPHA_VAL_U_ADDR A:0x6408020c
y.create.l HWIO_MSS_QDSP6SS_PLL_USER_CTL_ADDR A:0x64080210
y.create.l HWIO_MSS_QDSP6SS_PLL_USER_CTL_U_ADDR A:0x64080214
y.create.l HWIO_MSS_QDSP6SS_PLL_CONFIG_CTL_ADDR A:0x64080218
y.create.l HWIO_MSS_QDSP6SS_PLL_TEST_CTL_ADDR A:0x6408021c
y.create.l HWIO_MSS_QDSP6SS_PLL_TEST_CTL_U_ADDR A:0x64080220
y.create.l HWIO_MSS_QDSP6SS_PLL_STATUS_ADDR A:0x64080224
y.create.l HWIO_MSS_QDSP6SS_PLL_FREQ_CTL_ADDR A:0x64080228
y.create.l HWIO_MSS_QDSP6SS_PLL_RCG_UPDATE_CFG_ADDR A:0x64080240
y.create.l HWIO_MSS_QDSP6SS_PLL_RCG_UPDATE_DLYCTL_ADDR A:0x64080244
y.create.l HWIO_MSS_QDSP6SS_PLL_RCG_UPDATE_CMD_ADDR A:0x64080248
y.create.l HWIO_MSS_QDSP6SS_PLL_RCG_UPDATE_STATUS_ADDR A:0x6408023c
y.create.l HWIO_MSS_QDSP6SS_EXT_WAKEUP_ADDR A:0x64081000
y.create.l HWIO_MSS_QDSP6SS_EXT_PD_ADDR A:0x64081004
y.create.l HWIO_MSS_QDSP6SS_TEST_BUS_CTL_ADDR A:0x64082000
y.create.l HWIO_MSS_QDSP6SS_TEST_BUS_VALUE_ADDR A:0x64082004
y.create.l HWIO_MSS_QDSP6SS_TEST_BUS_WDATA_ADDR A:0x64082008
y.create.l HWIO_MSS_QDSP6SS_PWRDBG_CTL_ADDR A:0x6408200c
y.create.l HWIO_MSS_QDSP6SS_TEST_CLK_CTL_ADDR A:0x64082010
y.create.l HWIO_MSS_QDSP6SS_PWRDBG_STATUS_ADDR A:0x64082014
y.create.l HWIO_MSS_QDSP6SS_ZMEAS_CONFIG_ADDR A:0x64082018
y.create.l HWIO_MSS_QDSP6SS_LDO_ATEST_ADDR A:0x6408201c
y.create.l HWIO_MSS_QDSP6SS_LDO_DAC_STATUS_LOW_ADDR A:0x64082020
y.create.l HWIO_MSS_QDSP6SS_LDO_DAC_STATUS_HIGH_ADDR A:0x64082024
y.create.l HWIO_MSS_QDSP6SS_CORE_STATUS_ADDR A:0x64082028
y.create.l HWIO_QDSP6SS_INSTANCE_ID_ADDR A:0x64100000
y.create.l HWIO_QDSP6SS_IDLT_MATCH_VAL_ADDR A:0x64101000
y.create.l HWIO_QDSP6SS_IDLT_COUNT_VAL_ADDR A:0x64101004
y.create.l HWIO_QDSP6SS_IDLT_ENABLE_ADDR A:0x64101008
y.create.l HWIO_QDSP6SS_IDLT_SYNC_STATUS_ADDR A:0x6410100c
y.create.l HWIO_QDSP6SS_WDOG_RESET_ADDR A:0x64102000
y.create.l HWIO_QDSP6SS_WDOG_CTL_ADDR A:0x64102004
y.create.l HWIO_QDSP6SS_WDOG_STATUS_ADDR A:0x64102008
y.create.l HWIO_QDSP6SS_WDOG_BARK_TIME_ADDR A:0x6410200c
y.create.l HWIO_QDSP6SS_WDOG_BITE_TIME_ADDR A:0x64102010
y.create.l HWIO_QDSP6SS_WDOG_NMI_TIME_ADDR A:0x64102014
y.create.l HWIO_QDSP6SS_WDOG_TEST_LOAD_ADDR A:0x64102018
y.create.l HWIO_QDSP6SS_WDOG_TEST_ADDR A:0x6410201c
y.create.l HWIO_QDSP6SS_IPC_ADDR A:0x64105000
y.create.l HWIO_QDSP6SS_L1_IRQ_BACKUP_EN_ADDR A:0x64105010
y.create.l HWIO_QDSP6SS_BLOCK_INTR_ADDR A:0x64107008
y.create.l HWIO_QDSP6SS_PD_HS_START_ADDR A:0x6410700c
y.create.l HWIO_QDSP6SS_PD_HS_DONE_ADDR A:0x64107010
y.create.l HWIO_QDSP6SS_PU_HS_START_ADDR A:0x64107014
y.create.l HWIO_QDSP6SS_SLPC_CFG_ADDR A:0x6410701c
y.create.l HWIO_QDSP6SS_SLPC_STATUS_ADDR A:0x64107020
y.create.l HWIO_QDSP6SS_MVC_PWR_REQ_ADDR A:0x64107030
y.create.l HWIO_QDSP6SS_SPM_EVENT_CTL_ADDR A:0x64107050
y.create.l HWIO_QDSP6SS_SPM_TRIG_CFG0_ADDR A:0x64107080
y.create.l HWIO_QDSP6SS_SPM_TRIG_CFG1_ADDR A:0x64107084
y.create.l HWIO_QDSP6SS_SPMCTL_EN_ARES_ADDR A:0x64107100
y.create.l HWIO_QDSP6SS_SPMCTL_EN_CLAMP_ADDR A:0x64107104
y.create.l HWIO_QDSP6SS_SPMCTL_EN_CLK_ADDR A:0x64107108
y.create.l HWIO_QDSP6SS_SPMCTL_EN_MEM_ADDR A:0x6410710c
y.create.l HWIO_QDSP6SS_SPMCTL_EN_MEM_CP_ADDR A:0x64107110
y.create.l HWIO_QDSP6SS_SPMCTL_EN_BHS_ADDR A:0x64107114
y.create.l HWIO_QDSP6SS_SPMCTL_EN_LDO_ADDR A:0x64107118
y.create.l HWIO_QDSP6SS_SPMCTL_EN_EXT_ADDR A:0x6410711c
y.create.l HWIO_QDSP6SS_SPMCTL_EN_PLL_ADDR A:0x64107120
y.create.l HWIO_QDSP6SS_SPMCTL_EN_STATERET_ADDR A:0x64107124
y.create.l HWIO_QDSP6SS_SPMCTL_EN_ISOINTF_CTL_ADDR A:0x64107128
y.create.l HWIO_QDSP6SS_SPMCTL_EN_ISOINTF_CLAMP_ADDR A:0x6410712c
y.create.l HWIO_QDSP6SS_SPMCTL_EN_ISOINTF_CLK_ADDR A:0x64107130
y.create.l HWIO_QDSP6SS_SPMCTL_EN_ARES_SET_ADDR A:0x64107180
y.create.l HWIO_QDSP6SS_SPMCTL_EN_CLAMP_SET_ADDR A:0x64107184
y.create.l HWIO_QDSP6SS_SPMCTL_EN_CLK_SET_ADDR A:0x64107188
y.create.l HWIO_QDSP6SS_SPMCTL_EN_MEM_SET_ADDR A:0x6410718c
y.create.l HWIO_QDSP6SS_SPMCTL_EN_MEM_CP_SET_ADDR A:0x64107190
y.create.l HWIO_QDSP6SS_SPMCTL_EN_BHS_SET_ADDR A:0x64107194
y.create.l HWIO_QDSP6SS_SPMCTL_EN_LDO_SET_ADDR A:0x64107198
y.create.l HWIO_QDSP6SS_SPMCTL_EN_EXT_SET_ADDR A:0x6410719c
y.create.l HWIO_QDSP6SS_SPMCTL_EN_PLL_SET_ADDR A:0x641071a0
y.create.l HWIO_QDSP6SS_SPMCTL_EN_STATERET_SET_ADDR A:0x641071a4
y.create.l HWIO_QDSP6SS_SPMCTL_EN_ISOINTF_CTL_SET_ADDR A:0x641071a8
y.create.l HWIO_QDSP6SS_SPMCTL_EN_ISOINTF_CLAMP_SET_ADDR A:0x641071ac
y.create.l HWIO_QDSP6SS_SPMCTL_EN_ISOINTF_CLK_SET_ADDR A:0x641071b0
y.create.l HWIO_QDSP6SS_SPMCTL_EN_ARES_CLEAR_ADDR A:0x64107200
y.create.l HWIO_QDSP6SS_SPMCTL_EN_CLAMP_CLEAR_ADDR A:0x64107204
y.create.l HWIO_QDSP6SS_SPMCTL_EN_CLK_CLEAR_ADDR A:0x64107208
y.create.l HWIO_QDSP6SS_SPMCTL_EN_MEM_CLEAR_ADDR A:0x6410720c
y.create.l HWIO_QDSP6SS_SPMCTL_EN_MEM_CP_CLEAR_ADDR A:0x64107210
y.create.l HWIO_QDSP6SS_SPMCTL_EN_BHS_CLEAR_ADDR A:0x64107214
y.create.l HWIO_QDSP6SS_SPMCTL_EN_LDO_CLEAR_ADDR A:0x64107218
y.create.l HWIO_QDSP6SS_SPMCTL_EN_EXT_CLEAR_ADDR A:0x6410721c
y.create.l HWIO_QDSP6SS_SPMCTL_EN_PLL_CLEAR_ADDR A:0x64107220
y.create.l HWIO_QDSP6SS_SPMCTL_EN_STATERET_CLEAR_ADDR A:0x64107224
y.create.l HWIO_QDSP6SS_SPMCTL_EN_ISOINTF_CTL_CLEAR_ADDR A:0x64107228
y.create.l HWIO_QDSP6SS_SPMCTL_EN_ISOINTF_CLAMP_CLEAR_ADDR A:0x6410722c
y.create.l HWIO_QDSP6SS_SPMCTL_EN_ISOINTF_CLK_CLEAR_ADDR A:0x64107230
y.create.l HWIO_QDSP6SS_L2VIC_VID_ADDR A:0x64110000
y.create.l HWIO_QDSP6SS_L2VIC_INT_ENABLE0_ADDR A:0x64110100
y.create.l HWIO_QDSP6SS_L2VIC_INT_ENABLE1_ADDR A:0x64110104
y.create.l HWIO_QDSP6SS_L2VIC_INT_ENABLE2_ADDR A:0x64110108
y.create.l HWIO_QDSP6SS_L2VIC_INT_ENABLE3_ADDR A:0x6411010c
y.create.l HWIO_QDSP6SS_L2VIC_INT_ENABLE4_ADDR A:0x64110110
y.create.l HWIO_QDSP6SS_L2VIC_INT_ENABLE5_ADDR A:0x64110114
y.create.l HWIO_QDSP6SS_L2VIC_INT_ENABLE6_ADDR A:0x64110118
y.create.l HWIO_QDSP6SS_L2VIC_INT_ENABLE7_ADDR A:0x6411011c
y.create.l HWIO_QDSP6SS_L2VIC_INT_ENABLE8_ADDR A:0x64110120
y.create.l HWIO_QDSP6SS_L2VIC_INT_ENABLE9_ADDR A:0x64110124
y.create.l HWIO_QDSP6SS_L2VIC_INT_ENABLE_CLEAR0_ADDR A:0x64110180
y.create.l HWIO_QDSP6SS_L2VIC_INT_ENABLE_CLEAR1_ADDR A:0x64110184
y.create.l HWIO_QDSP6SS_L2VIC_INT_ENABLE_CLEAR2_ADDR A:0x64110188
y.create.l HWIO_QDSP6SS_L2VIC_INT_ENABLE_CLEAR3_ADDR A:0x6411018c
y.create.l HWIO_QDSP6SS_L2VIC_INT_ENABLE_CLEAR4_ADDR A:0x64110190
y.create.l HWIO_QDSP6SS_L2VIC_INT_ENABLE_CLEAR5_ADDR A:0x64110194
y.create.l HWIO_QDSP6SS_L2VIC_INT_ENABLE_CLEAR6_ADDR A:0x64110198
y.create.l HWIO_QDSP6SS_L2VIC_INT_ENABLE_CLEAR7_ADDR A:0x6411019c
y.create.l HWIO_QDSP6SS_L2VIC_INT_ENABLE_CLEAR8_ADDR A:0x641101a0
y.create.l HWIO_QDSP6SS_L2VIC_INT_ENABLE_CLEAR9_ADDR A:0x641101a4
y.create.l HWIO_QDSP6SS_L2VIC_INT_ENABLE_SET0_ADDR A:0x64110200
y.create.l HWIO_QDSP6SS_L2VIC_INT_ENABLE_SET1_ADDR A:0x64110204
y.create.l HWIO_QDSP6SS_L2VIC_INT_ENABLE_SET2_ADDR A:0x64110208
y.create.l HWIO_QDSP6SS_L2VIC_INT_ENABLE_SET3_ADDR A:0x6411020c
y.create.l HWIO_QDSP6SS_L2VIC_INT_ENABLE_SET4_ADDR A:0x64110210
y.create.l HWIO_QDSP6SS_L2VIC_INT_ENABLE_SET5_ADDR A:0x64110214
y.create.l HWIO_QDSP6SS_L2VIC_INT_ENABLE_SET6_ADDR A:0x64110218
y.create.l HWIO_QDSP6SS_L2VIC_INT_ENABLE_SET7_ADDR A:0x6411021c
y.create.l HWIO_QDSP6SS_L2VIC_INT_ENABLE_SET8_ADDR A:0x64110220
y.create.l HWIO_QDSP6SS_L2VIC_INT_ENABLE_SET9_ADDR A:0x64110224
y.create.l HWIO_QDSP6SS_L2VIC_INT_TYPE0_ADDR A:0x64110280
y.create.l HWIO_QDSP6SS_L2VIC_INT_TYPE1_ADDR A:0x64110284
y.create.l HWIO_QDSP6SS_L2VIC_INT_TYPE2_ADDR A:0x64110288
y.create.l HWIO_QDSP6SS_L2VIC_INT_TYPE3_ADDR A:0x6411028c
y.create.l HWIO_QDSP6SS_L2VIC_INT_TYPE4_ADDR A:0x64110290
y.create.l HWIO_QDSP6SS_L2VIC_INT_TYPE5_ADDR A:0x64110294
y.create.l HWIO_QDSP6SS_L2VIC_INT_TYPE6_ADDR A:0x64110298
y.create.l HWIO_QDSP6SS_L2VIC_INT_TYPE7_ADDR A:0x6411029c
y.create.l HWIO_QDSP6SS_L2VIC_INT_TYPE8_ADDR A:0x641102a0
y.create.l HWIO_QDSP6SS_L2VIC_INT_TYPE9_ADDR A:0x641102a4
y.create.l HWIO_QDSP6SS_L2VIC_INT_STATUS0_ADDR A:0x64110380
y.create.l HWIO_QDSP6SS_L2VIC_INT_STATUS1_ADDR A:0x64110384
y.create.l HWIO_QDSP6SS_L2VIC_INT_STATUS2_ADDR A:0x64110388
y.create.l HWIO_QDSP6SS_L2VIC_INT_STATUS3_ADDR A:0x6411038c
y.create.l HWIO_QDSP6SS_L2VIC_INT_STATUS4_ADDR A:0x64110390
y.create.l HWIO_QDSP6SS_L2VIC_INT_STATUS5_ADDR A:0x64110394
y.create.l HWIO_QDSP6SS_L2VIC_INT_STATUS6_ADDR A:0x64110398
y.create.l HWIO_QDSP6SS_L2VIC_INT_STATUS7_ADDR A:0x6411039c
y.create.l HWIO_QDSP6SS_L2VIC_INT_STATUS8_ADDR A:0x641103a0
y.create.l HWIO_QDSP6SS_L2VIC_INT_STATUS9_ADDR A:0x641103a4
y.create.l HWIO_QDSP6SS_L2VIC_INT_CLEAR0_ADDR A:0x64110400
y.create.l HWIO_QDSP6SS_L2VIC_INT_CLEAR1_ADDR A:0x64110404
y.create.l HWIO_QDSP6SS_L2VIC_INT_CLEAR2_ADDR A:0x64110408
y.create.l HWIO_QDSP6SS_L2VIC_INT_CLEAR3_ADDR A:0x6411040c
y.create.l HWIO_QDSP6SS_L2VIC_INT_CLEAR4_ADDR A:0x64110410
y.create.l HWIO_QDSP6SS_L2VIC_INT_CLEAR5_ADDR A:0x64110414
y.create.l HWIO_QDSP6SS_L2VIC_INT_CLEAR6_ADDR A:0x64110418
y.create.l HWIO_QDSP6SS_L2VIC_INT_CLEAR7_ADDR A:0x6411041c
y.create.l HWIO_QDSP6SS_L2VIC_INT_CLEAR8_ADDR A:0x64110420
y.create.l HWIO_QDSP6SS_L2VIC_INT_CLEAR9_ADDR A:0x64110424
y.create.l HWIO_QDSP6SS_L2VIC_SOFT_INT0_ADDR A:0x64110480
y.create.l HWIO_QDSP6SS_L2VIC_SOFT_INT1_ADDR A:0x64110484
y.create.l HWIO_QDSP6SS_L2VIC_SOFT_INT2_ADDR A:0x64110488
y.create.l HWIO_QDSP6SS_L2VIC_SOFT_INT3_ADDR A:0x6411048c
y.create.l HWIO_QDSP6SS_L2VIC_SOFT_INT4_ADDR A:0x64110490
y.create.l HWIO_QDSP6SS_L2VIC_SOFT_INT5_ADDR A:0x64110494
y.create.l HWIO_QDSP6SS_L2VIC_SOFT_INT6_ADDR A:0x64110498
y.create.l HWIO_QDSP6SS_L2VIC_SOFT_INT7_ADDR A:0x6411049c
y.create.l HWIO_QDSP6SS_L2VIC_SOFT_INT8_ADDR A:0x641104a0
y.create.l HWIO_QDSP6SS_L2VIC_SOFT_INT9_ADDR A:0x641104a4
y.create.l HWIO_QDSP6SS_L2VIC_INT_PENDING0_ADDR A:0x64110500
y.create.l HWIO_QDSP6SS_L2VIC_INT_PENDING1_ADDR A:0x64110504
y.create.l HWIO_QDSP6SS_L2VIC_INT_PENDING2_ADDR A:0x64110508
y.create.l HWIO_QDSP6SS_L2VIC_INT_PENDING3_ADDR A:0x6411050c
y.create.l HWIO_QDSP6SS_L2VIC_INT_PENDING4_ADDR A:0x64110510
y.create.l HWIO_QDSP6SS_L2VIC_INT_PENDING5_ADDR A:0x64110514
y.create.l HWIO_QDSP6SS_L2VIC_INT_PENDING6_ADDR A:0x64110518
y.create.l HWIO_QDSP6SS_L2VIC_INT_PENDING7_ADDR A:0x6411051c
y.create.l HWIO_QDSP6SS_L2VIC_INT_PENDING8_ADDR A:0x64110520
y.create.l HWIO_QDSP6SS_L2VIC_INT_PENDING9_ADDR A:0x64110524
y.create.l HWIO_QDSP6SS_QTMR_AC_CNTFRQ_ADDR A:0x64120000
y.create.l HWIO_QDSP6SS_QTMR_AC_CNTSR_ADDR A:0x64120004
y.create.l HWIO_QDSP6SS_QTMR_AC_CNTTID_ADDR A:0x64120008
y.create.l HWIO_QDSP6SS_QTMR_AC_CNTACR_0_ADDR A:0x64120040
y.create.l HWIO_QDSP6SS_QTMR_AC_CNTACR_1_ADDR A:0x64120044
y.create.l HWIO_QDSP6SS_QTMR_AC_CNTACR_2_ADDR A:0x64120048
y.create.l HWIO_QDSP6SS_QTMR_AC_CNTVOFF_LO_0_ADDR A:0x64120080
y.create.l HWIO_QDSP6SS_QTMR_AC_CNTVOFF_LO_1_ADDR A:0x64120088
y.create.l HWIO_QDSP6SS_QTMR_AC_CNTVOFF_LO_2_ADDR A:0x64120090
y.create.l HWIO_QDSP6SS_QTMR_AC_CNTVOFF_HI_0_ADDR A:0x64120084
y.create.l HWIO_QDSP6SS_QTMR_AC_CNTVOFF_HI_1_ADDR A:0x6412008c
y.create.l HWIO_QDSP6SS_QTMR_AC_CNTVOFF_HI_2_ADDR A:0x64120094
y.create.l HWIO_QDSP6SS_QTMR_AC_CFG_ADDR A:0x64120fc0
y.create.l HWIO_QDSP6SS_QTMR_AC_VERSION_ADDR A:0x64120fd0
y.create.l HWIO_QDSP6SS_QTMR_V1_CNTPCT_LO_0_ADDR A:0x64121000
y.create.l HWIO_QDSP6SS_QTMR_V1_CNTPCT_HI_0_ADDR A:0x64121004
y.create.l HWIO_QDSP6SS_QTMR_V1_CNTVCT_LO_0_ADDR A:0x64121008
y.create.l HWIO_QDSP6SS_QTMR_V1_CNTVCT_HI_0_ADDR A:0x6412100c
y.create.l HWIO_QDSP6SS_QTMR_V1_CNTFRQ_0_ADDR A:0x64121010
y.create.l HWIO_QDSP6SS_QTMR_V1_CNTPL0ACR_0_ADDR A:0x64121014
y.create.l HWIO_QDSP6SS_QTMR_V1_CNTVOFF_LO_0_ADDR A:0x64121018
y.create.l HWIO_QDSP6SS_QTMR_V1_CNTVOFF_HI_0_ADDR A:0x6412101c
y.create.l HWIO_QDSP6SS_QTMR_V1_CNTP_CVAL_LO_0_ADDR A:0x64121020
y.create.l HWIO_QDSP6SS_QTMR_V1_CNTP_CVAL_HI_0_ADDR A:0x64121024
y.create.l HWIO_QDSP6SS_QTMR_V1_CNTP_TVAL_0_ADDR A:0x64121028
y.create.l HWIO_QDSP6SS_QTMR_V1_CNTP_CTL_0_ADDR A:0x6412102c
y.create.l HWIO_QDSP6SS_QTMR_V1_CNTV_CVAL_LO_0_ADDR A:0x64121030
y.create.l HWIO_QDSP6SS_QTMR_V1_CNTV_CVAL_HI_0_ADDR A:0x64121034
y.create.l HWIO_QDSP6SS_QTMR_V1_CNTV_TVAL_0_ADDR A:0x64121038
y.create.l HWIO_QDSP6SS_QTMR_V1_CNTV_CTL_0_ADDR A:0x6412103c
y.create.l HWIO_QDSP6SS_QTMR_V1_VERSION_0_ADDR A:0x64121fd0
y.create.l HWIO_QDSP6SS_QTMR_V1_CNTPCT_LO_1_ADDR A:0x64122000
y.create.l HWIO_QDSP6SS_QTMR_V1_CNTPCT_HI_1_ADDR A:0x64122004
y.create.l HWIO_QDSP6SS_QTMR_V1_CNTVCT_LO_1_ADDR A:0x64122008
y.create.l HWIO_QDSP6SS_QTMR_V1_CNTVCT_HI_1_ADDR A:0x6412200c
y.create.l HWIO_QDSP6SS_QTMR_V1_CNTFRQ_1_ADDR A:0x64122010
y.create.l HWIO_QDSP6SS_QTMR_V1_CNTPL0ACR_1_ADDR A:0x64122014
y.create.l HWIO_QDSP6SS_QTMR_V1_CNTVOFF_LO_1_ADDR A:0x64122018
y.create.l HWIO_QDSP6SS_QTMR_V1_CNTVOFF_HI_1_ADDR A:0x6412201c
y.create.l HWIO_QDSP6SS_QTMR_V1_CNTP_CVAL_LO_1_ADDR A:0x64122020
y.create.l HWIO_QDSP6SS_QTMR_V1_CNTP_CVAL_HI_1_ADDR A:0x64122024
y.create.l HWIO_QDSP6SS_QTMR_V1_CNTP_TVAL_1_ADDR A:0x64122028
y.create.l HWIO_QDSP6SS_QTMR_V1_CNTP_CTL_1_ADDR A:0x6412202c
y.create.l HWIO_QDSP6SS_QTMR_V1_CNTV_CVAL_LO_1_ADDR A:0x64122030
y.create.l HWIO_QDSP6SS_QTMR_V1_CNTV_CVAL_HI_1_ADDR A:0x64122034
y.create.l HWIO_QDSP6SS_QTMR_V1_CNTV_TVAL_1_ADDR A:0x64122038
y.create.l HWIO_QDSP6SS_QTMR_V1_CNTV_CTL_1_ADDR A:0x6412203c
y.create.l HWIO_QDSP6SS_QTMR_V1_VERSION_1_ADDR A:0x64122fd0
y.create.l HWIO_QDSP6SS_QTMR_V1_CNTPCT_LO_2_ADDR A:0x64123000
y.create.l HWIO_QDSP6SS_QTMR_V1_CNTPCT_HI_2_ADDR A:0x64123004
y.create.l HWIO_QDSP6SS_QTMR_V1_CNTVCT_LO_2_ADDR A:0x64123008
y.create.l HWIO_QDSP6SS_QTMR_V1_CNTVCT_HI_2_ADDR A:0x6412300c
y.create.l HWIO_QDSP6SS_QTMR_V1_CNTFRQ_2_ADDR A:0x64123010
y.create.l HWIO_QDSP6SS_QTMR_V1_CNTPL0ACR_2_ADDR A:0x64123014
y.create.l HWIO_QDSP6SS_QTMR_V1_CNTVOFF_LO_2_ADDR A:0x64123018
y.create.l HWIO_QDSP6SS_QTMR_V1_CNTVOFF_HI_2_ADDR A:0x6412301c
y.create.l HWIO_QDSP6SS_QTMR_V1_CNTP_CVAL_LO_2_ADDR A:0x64123020
y.create.l HWIO_QDSP6SS_QTMR_V1_CNTP_CVAL_HI_2_ADDR A:0x64123024
y.create.l HWIO_QDSP6SS_QTMR_V1_CNTP_TVAL_2_ADDR A:0x64123028
y.create.l HWIO_QDSP6SS_QTMR_V1_CNTP_CTL_2_ADDR A:0x6412302c
y.create.l HWIO_QDSP6SS_QTMR_V1_CNTV_CVAL_LO_2_ADDR A:0x64123030
y.create.l HWIO_QDSP6SS_QTMR_V1_CNTV_CVAL_HI_2_ADDR A:0x64123034
y.create.l HWIO_QDSP6SS_QTMR_V1_CNTV_TVAL_2_ADDR A:0x64123038
y.create.l HWIO_QDSP6SS_QTMR_V1_CNTV_CTL_2_ADDR A:0x6412303c
y.create.l HWIO_QDSP6SS_QTMR_V1_VERSION_2_ADDR A:0x64123fd0
y.create.l HWIO_QDSP6SS_SAW2_SECURE_ADDR A:0x64130000
y.create.l HWIO_QDSP6SS_SAW2_ID_ADDR A:0x64130004
y.create.l HWIO_QDSP6SS_SAW2_CFG_ADDR A:0x64130008
y.create.l HWIO_QDSP6SS_SAW2_SPM_STS_ADDR A:0x6413000c
y.create.l HWIO_QDSP6SS_SAW2_AVS_STS_ADDR A:0x64130010
y.create.l HWIO_QDSP6SS_SAW2_PMIC_STS_ADDR A:0x64130014
y.create.l HWIO_QDSP6SS_SAW2_RST_ADDR A:0x64130018
y.create.l HWIO_QDSP6SS_SAW2_SPM_CTL_ADDR A:0x64130030
y.create.l HWIO_QDSP6SS_SAW2_SPM_DLY_ADDR A:0x64130034
y.create.l HWIO_QDSP6SS_SAW2_SPM_STS2_ADDR A:0x64130038
y.create.l HWIO_QDSP6SS_SAW2_SPM_SLP_SEQ_ENTRY_0_ADDR A:0x64130400
y.create.l HWIO_QDSP6SS_SAW2_SPM_SLP_SEQ_ENTRY_1_ADDR A:0x64130404
y.create.l HWIO_QDSP6SS_SAW2_SPM_SLP_SEQ_ENTRY_2_ADDR A:0x64130408
y.create.l HWIO_QDSP6SS_SAW2_SPM_SLP_SEQ_ENTRY_3_ADDR A:0x6413040c
y.create.l HWIO_QDSP6SS_SAW2_SPM_SLP_SEQ_ENTRY_4_ADDR A:0x64130410
y.create.l HWIO_QDSP6SS_SAW2_SPM_SLP_SEQ_ENTRY_5_ADDR A:0x64130414
y.create.l HWIO_QDSP6SS_SAW2_SPM_SLP_SEQ_ENTRY_6_ADDR A:0x64130418
y.create.l HWIO_QDSP6SS_SAW2_SPM_SLP_SEQ_ENTRY_7_ADDR A:0x6413041c
y.create.l HWIO_QDSP6SS_SAW2_SPM_SLP_SEQ_ENTRY_8_ADDR A:0x64130420
y.create.l HWIO_QDSP6SS_SAW2_SPM_SLP_SEQ_ENTRY_9_ADDR A:0x64130424
y.create.l HWIO_QDSP6SS_SAW2_VERSION_ADDR A:0x64130fd0
y.create.l HWIO_MSS_ENABLE_ADDR A:0x64180000
y.create.l HWIO_MSS_CLAMP_MEM_ADDR A:0x64180004
y.create.l HWIO_MSS_CLAMP_IO_ADDR A:0x64180008
y.create.l HWIO_MSS_BUS_AHB2AHB_CFG_ADDR A:0x6418000c
y.create.l HWIO_MSS_BUS_MAXI2AXI_CFG_ADDR A:0x64180010
y.create.l HWIO_MSS_CUSTOM_MEM_ARRSTBYN_ADDR A:0x64180014
y.create.l HWIO_MSS_ANALOG_IP_TEST_CTL_ADDR A:0x64180018
y.create.l HWIO_MSS_ATB_ID_ADDR A:0x6418001c
y.create.l HWIO_MSS_DBG_BUS_CTL_ADDR A:0x64180020
y.create.l HWIO_MSS_AHB_ACCESS_ERR_IRQ_EN_ADDR A:0x64180024
y.create.l HWIO_MSS_AHB_ACCESS_ERR_IRQ_STATUS_ADDR A:0x64180028
y.create.l HWIO_MSS_AHB_ACCESS_ERR_IRQ_CLR_ADDR A:0x6418002c
y.create.l HWIO_MSS_BUS_CTL_CFG_ADDR A:0x64180030
y.create.l HWIO_MSS_MSA_ADDR A:0x64180058
y.create.l HWIO_MSS_HW_VERSION_ADDR A:0x6418005c
y.create.l HWIO_MSS_MODEM_MEM_SLP_CNTL_ADDR A:0x64180060
y.create.l HWIO_MSS_CLOCK_SPDM_MON_ADDR A:0x64180064
y.create.l HWIO_MSS_BBRX0_MUX_SEL_ADDR A:0x64180068
y.create.l HWIO_MSS_BBRX1_MUX_SEL_ADDR A:0x6418006c
y.create.l HWIO_MSS_BBRX2_MUX_SEL_ADDR A:0x64180070
y.create.l HWIO_MSS_BBRX3_MUX_SEL_ADDR A:0x64180074
y.create.l HWIO_MSS_DEBUG_CLOCK_CTL_ADDR A:0x64180078
y.create.l HWIO_MSS_BBRX_EXT_CLOCK_MUX_SEL_ADDR A:0x6418007c
y.create.l HWIO_MSS_BBRX_CTL_ADDR A:0x64180094
y.create.l HWIO_MSS_DEBUG_CTL_ADDR A:0x64180098
y.create.l HWIO_MSS_POWER_ADDR A:0x6418009c
y.create.l HWIO_MSS_MSA_NC_HM_ADDR A:0x641800a0
y.create.l HWIO_MSS_CXM_ADDR A:0x641800a4
y.create.l HWIO_MSS_RELAY_MSG_SHADOW_00_ADDR A:0x64180400
y.create.l HWIO_MSS_RELAY_MSG_SHADOW_01_ADDR A:0x64180404
y.create.l HWIO_MSS_RELAY_MSG_SHADOW_02_ADDR A:0x64180408
y.create.l HWIO_MSS_RELAY_MSG_SHADOW_03_ADDR A:0x6418040c
y.create.l HWIO_MSS_RELAY_MSG_SHADOW_04_ADDR A:0x64180410
y.create.l HWIO_MSS_RELAY_MSG_SHADOW_05_ADDR A:0x64180414
y.create.l HWIO_MSS_RELAY_MSG_SHADOW_06_ADDR A:0x64180418
y.create.l HWIO_MSS_RELAY_MSG_SHADOW_07_ADDR A:0x6418041c
y.create.l HWIO_MSS_RELAY_MSG_SHADOW_08_ADDR A:0x64180420
y.create.l HWIO_MSS_RELAY_MSG_SHADOW_09_ADDR A:0x64180424
y.create.l HWIO_MSS_RELAY_MSG_SHADOW_10_ADDR A:0x64180428
y.create.l HWIO_MSS_RELAY_MSG_SHADOW_11_ADDR A:0x6418042c
y.create.l HWIO_MSS_RELAY_MSG_SHADOW_12_ADDR A:0x64180430
y.create.l HWIO_MSS_RELAY_MSG_SHADOW_13_ADDR A:0x64180434
y.create.l HWIO_MSS_RELAY_MSG_SHADOW_14_ADDR A:0x64180438
y.create.l HWIO_MSS_RELAY_MSG_SHADOW_15_ADDR A:0x6418043c
y.create.l HWIO_MSS_MPLL1_MODE_ADDR A:0x64181020
y.create.l HWIO_MSS_MPLL1_L_VAL_ADDR A:0x64181024
y.create.l HWIO_MSS_MPLL1_M_VAL_ADDR A:0x64181028
y.create.l HWIO_MSS_MPLL1_N_VAL_ADDR A:0x6418102c
y.create.l HWIO_MSS_MPLL1_USER_CTL_ADDR A:0x64181030
y.create.l HWIO_MSS_MPLL1_CONFIG_CTL_ADDR A:0x64181034
y.create.l HWIO_MSS_MPLL1_TEST_CTL_ADDR A:0x64181038
y.create.l HWIO_MSS_MPLL1_STATUS_ADDR A:0x6418103c
y.create.l HWIO_MSS_UIM0_BCR_ADDR A:0x64181060
y.create.l HWIO_MSS_UIM1_BCR_ADDR A:0x64181064
y.create.l HWIO_MSS_Q6SS_BCR_ADDR A:0x64181068
y.create.l HWIO_MSS_NAV_CE_BRIDGE_BCR_ADDR A:0x6418106c
y.create.l HWIO_MSS_CRYPTO_BCR_ADDR A:0x64181070
y.create.l HWIO_MSS_NAV_BCR_ADDR A:0x64181074
y.create.l HWIO_MSS_UIM0_CBCR_ADDR A:0x64181078
y.create.l HWIO_MSS_UIM1_CBCR_ADDR A:0x6418107c
y.create.l HWIO_MSS_XO_UIM0_CBCR_ADDR A:0x64181080
y.create.l HWIO_MSS_XO_UIM1_CBCR_ADDR A:0x64181084
y.create.l HWIO_MSS_XO_MODEM_CBCR_ADDR A:0x64181088
y.create.l HWIO_MSS_BUS_UIM0_CBCR_ADDR A:0x64181090
y.create.l HWIO_MSS_BUS_UIM1_CBCR_ADDR A:0x64181094
y.create.l HWIO_MSS_BUS_CSR_CBCR_ADDR A:0x64181098
y.create.l HWIO_MSS_BUS_BRIDGE_CBCR_ADDR A:0x6418109c
y.create.l HWIO_MSS_BUS_MODEM_CBCR_ADDR A:0x641810a0
y.create.l HWIO_MSS_BUS_Q6_CBCR_ADDR A:0x641810a4
y.create.l HWIO_MSS_BUS_NAV_CE_BRIDGE_CBCR_ADDR A:0x641810a8
y.create.l HWIO_MSS_BUS_CRYPTO_CBCR_ADDR A:0x641810ac
y.create.l HWIO_MSS_BUS_NAV_CBCR_ADDR A:0x641810b0
y.create.l HWIO_MSS_BUS_ATB_CBCR_ADDR A:0x641810b8
y.create.l HWIO_MSS_BUS_MODEM_BRIDGE_CX_CBCR_ADDR A:0x641810c0
y.create.l HWIO_MSS_BUS_SLAVE_TIMEOUT_CBCR_ADDR A:0x641810c4
y.create.l HWIO_MSS_BUS_COMBODAC_COMP_CBCR_ADDR A:0x641810cc
y.create.l HWIO_MSS_MODEM_CFG_AHB_CBCR_ADDR A:0x641810d4
y.create.l HWIO_MSS_MODEM_SNOC_AXI_CBCR_ADDR A:0x641810d8
y.create.l HWIO_MSS_NAV_SNOC_AXI_CBCR_ADDR A:0x641810dc
y.create.l HWIO_MSS_MPLL2_MAIN_BUS_CBCR_ADDR A:0x641810e0
y.create.l HWIO_MSS_MPLL1_MAIN_CBCR_ADDR A:0x641810e8
y.create.l HWIO_MSS_MPLL1_MAIN_BUS_CBCR_ADDR A:0x641810ec
y.create.l HWIO_MSS_MPLL1_EARLY_DIV5_CBCR_ADDR A:0x641810f0
y.create.l HWIO_MSS_MPLL1_EARLY_DIV3_CBCR_ADDR A:0x641810f4
y.create.l HWIO_MSS_MPLL1_OUT_EARLY_DIV3_CBCR_ADDR A:0x64181100
y.create.l HWIO_MSS_MPLL1_OUT_EARLY_DIV5_CBCR_ADDR A:0x64181104
y.create.l HWIO_MSS_BUS_CMD_RCGR_ADDR A:0x64181108
y.create.l HWIO_MSS_BUS_CFG_RCGR_ADDR A:0x6418110c
y.create.l HWIO_MSS_Q6_CMD_RCGR_ADDR A:0x64181110
y.create.l HWIO_MSS_Q6_CFG_RCGR_ADDR A:0x64181114
y.create.l HWIO_MSS_UIM_CMD_RCGR_ADDR A:0x64181118
y.create.l HWIO_MSS_UIM_CFG_RCGR_ADDR A:0x6418111c
y.create.l HWIO_MSS_BBRX0_CBCR_ADDR A:0x64181120
y.create.l HWIO_MSS_BBRX1_CBCR_ADDR A:0x64181124
y.create.l HWIO_MSS_BBRX2_CBCR_ADDR A:0x64181128
y.create.l HWIO_MSS_BBRX3_CBCR_ADDR A:0x6418112c
y.create.l HWIO_MSS_BIMC_THROTTLE_ADDR A:0x64181130
y.create.l HWIO_MSS_RESERVE_02_ADDR A:0x64181134
y.create.l HWIO_MSS_BBRX0_MISC_ADDR A:0x64181138
y.create.l HWIO_MSS_BBRX1_MISC_ADDR A:0x6418113c
y.create.l HWIO_MSS_BBRX2_MISC_ADDR A:0x64181140
y.create.l HWIO_MSS_BBRX3_MISC_ADDR A:0x64181144
y.create.l HWIO_MSS_UIM0_MND_CMD_RCGR_ADDR A:0x64181150
y.create.l HWIO_MSS_UIM0_MND_CFG_RCGR_ADDR A:0x64181154
y.create.l HWIO_MSS_UIM0_MND_M_ADDR A:0x64181158
y.create.l HWIO_MSS_UIM0_MND_N_ADDR A:0x6418115c
y.create.l HWIO_MSS_UIM0_MND_D_ADDR A:0x64181160
y.create.l HWIO_MSS_UIM1_MND_CMD_RCGR_ADDR A:0x64181164
y.create.l HWIO_MSS_UIM1_MND_CFG_RCGR_ADDR A:0x64181168
y.create.l HWIO_MSS_UIM1_MND_M_ADDR A:0x6418116c
y.create.l HWIO_MSS_UIM1_MND_N_ADDR A:0x64181170
y.create.l HWIO_MSS_UIM1_MND_D_ADDR A:0x64181174
y.create.l HWIO_MSS_UIM2_BCR_ADDR A:0x64181178
y.create.l HWIO_MSS_UIM2_CBCR_ADDR A:0x6418117c
y.create.l HWIO_MSS_XO_UIM2_CBCR_ADDR A:0x64181180
y.create.l HWIO_MSS_BUS_UIM2_CBCR_ADDR A:0x64181184
y.create.l HWIO_MSS_UIM2_MND_CMD_RCGR_ADDR A:0x64181188
y.create.l HWIO_MSS_UIM2_MND_CFG_RCGR_ADDR A:0x6418118c
y.create.l HWIO_MSS_UIM2_MND_M_ADDR A:0x64181190
y.create.l HWIO_MSS_UIM2_MND_N_ADDR A:0x64181194
y.create.l HWIO_MSS_UIM2_MND_D_ADDR A:0x64181198
y.create.l HWIO_MSS_BUS_MGPI_CBCR_ADDR A:0x6418119c
y.create.l HWIO_MSS_MGPI_BCR_ADDR A:0x641811a0
y.create.l HWIO_MSS_TCSR_ACC_SEL_ADDR A:0x6418f000
y.create.l HWIO_MSS_UIM0_UART_DM_MR1_ADDR A:0x64190000
y.create.l HWIO_MSS_UIM0_UART_DM_MR2_ADDR A:0x64190004
y.create.l HWIO_MSS_UIM0_UART_DM_CSR_SR_DEPRECATED_ADDR A:0x64190008
y.create.l HWIO_MSS_UIM0_UART_DM_CR_MISR_DEPRECATED_ADDR A:0x64190010
y.create.l HWIO_MSS_UIM0_UART_DM_IMR_ISR_DEPRECATED_ADDR A:0x64190014
y.create.l HWIO_MSS_UIM0_UART_DM_IPR_ADDR A:0x64190018
y.create.l HWIO_MSS_UIM0_UART_DM_TFWR_ADDR A:0x6419001c
y.create.l HWIO_MSS_UIM0_UART_DM_RFWR_ADDR A:0x64190020
y.create.l HWIO_MSS_UIM0_UART_DM_HCR_ADDR A:0x64190024
y.create.l HWIO_MSS_UIM0_UART_DM_DMRX_ADDR A:0x64190034
y.create.l HWIO_MSS_UIM0_UART_DM_IRDA_RX_TOTAL_SNAP_DEPRECATED_ADDR A:0x64190038
y.create.l HWIO_MSS_UIM0_UART_DM_DMEN_ADDR A:0x6419003c
y.create.l HWIO_MSS_UIM0_UART_DM_NO_CHARS_FOR_TX_ADDR A:0x64190040
y.create.l HWIO_MSS_UIM0_UART_DM_BADR_ADDR A:0x64190044
y.create.l HWIO_MSS_UIM0_UART_DM_TESTSL_ADDR A:0x64190048
y.create.l HWIO_MSS_UIM0_UART_DM_TXFS_ADDR A:0x6419004c
y.create.l HWIO_MSS_UIM0_UART_DM_RXFS_ADDR A:0x64190050
y.create.l HWIO_MSS_UIM0_UART_DM_MISR_MODE_ADDR A:0x64190060
y.create.l HWIO_MSS_UIM0_UART_DM_MISR_RESET_ADDR A:0x64190064
y.create.l HWIO_MSS_UIM0_UART_DM_MISR_EXPORT_ADDR A:0x64190068
y.create.l HWIO_MSS_UIM0_UART_DM_MISR_VAL_ADDR A:0x6419006c
y.create.l HWIO_MSS_UIM0_UART_DM_TF_RF_DEPRECATED_ADDR A:0x64190070
y.create.l HWIO_MSS_UIM0_UART_DM_TF_RF_2_DEPRECATED_ADDR A:0x64190074
y.create.l HWIO_MSS_UIM0_UART_DM_TF_RF_3_DEPRECATED_ADDR A:0x64190078
y.create.l HWIO_MSS_UIM0_UART_DM_TF_RF_4_DEPRECATED_ADDR A:0x6419007c
y.create.l HWIO_MSS_UIM0_UART_DM_SIM_CFG_ADDR A:0x64190080
y.create.l HWIO_MSS_UIM0_UART_DM_TEST_WR_ADDR_ADDR A:0x64190084
y.create.l HWIO_MSS_UIM0_UART_DM_TEST_WR_DATA_ADDR A:0x64190088
y.create.l HWIO_MSS_UIM0_UART_DM_TEST_RD_ADDR_ADDR A:0x6419008c
y.create.l HWIO_MSS_UIM0_UART_DM_TEST_RD_DATA_ADDR A:0x64190090
y.create.l HWIO_MSS_UIM0_UART_DM_CSR_ADDR A:0x641900a0
y.create.l HWIO_MSS_UIM0_UART_DM_SR_ADDR A:0x641900a4
y.create.l HWIO_MSS_UIM0_UART_DM_CR_ADDR A:0x641900a8
y.create.l HWIO_MSS_UIM0_UART_DM_MISR_ADDR A:0x641900ac
y.create.l HWIO_MSS_UIM0_UART_DM_IMR_ADDR A:0x641900b0
y.create.l HWIO_MSS_UIM0_UART_DM_ISR_ADDR A:0x641900b4
y.create.l HWIO_MSS_UIM0_UART_DM_IRDA_ADDR A:0x641900b8
y.create.l HWIO_MSS_UIM0_UART_DM_RX_TOTAL_SNAP_ADDR A:0x641900bc
y.create.l HWIO_MSS_UIM0_UART_DM_WWT_TIMEOUT_ADDR A:0x641900c0
y.create.l HWIO_MSS_UIM0_UART_DM_CLK_CTRL_ADDR A:0x641900c4
y.create.l HWIO_MSS_UIM0_UART_DM_BCR_ADDR A:0x641900c8
y.create.l HWIO_MSS_UIM0_UART_DM_RX_TRANS_CTRL_ADDR A:0x641900cc
y.create.l HWIO_MSS_UIM0_UART_DM_DMRX_DBG_ADDR A:0x641900d0
y.create.l HWIO_MSS_UIM0_UART_DM_FSM_STATUS_ADDR A:0x641900d4
y.create.l HWIO_MSS_UIM0_UART_DM_HW_VERSION_ADDR A:0x641900d8
y.create.l HWIO_MSS_UIM0_UART_DM_GENERICS_ADDR A:0x641900dc
y.create.l HWIO_MSS_UIM0_UART_DM_TF_ADDR A:0x64190100
y.create.l HWIO_MSS_UIM0_UART_DM_TF_2_ADDR A:0x64190104
y.create.l HWIO_MSS_UIM0_UART_DM_TF_3_ADDR A:0x64190108
y.create.l HWIO_MSS_UIM0_UART_DM_TF_4_ADDR A:0x6419010c
y.create.l HWIO_MSS_UIM0_UART_DM_TF_5_ADDR A:0x64190110
y.create.l HWIO_MSS_UIM0_UART_DM_TF_6_ADDR A:0x64190114
y.create.l HWIO_MSS_UIM0_UART_DM_TF_7_ADDR A:0x64190118
y.create.l HWIO_MSS_UIM0_UART_DM_TF_8_ADDR A:0x6419011c
y.create.l HWIO_MSS_UIM0_UART_DM_TF_9_ADDR A:0x64190120
y.create.l HWIO_MSS_UIM0_UART_DM_TF_10_ADDR A:0x64190124
y.create.l HWIO_MSS_UIM0_UART_DM_TF_11_ADDR A:0x64190128
y.create.l HWIO_MSS_UIM0_UART_DM_TF_12_ADDR A:0x6419012c
y.create.l HWIO_MSS_UIM0_UART_DM_TF_13_ADDR A:0x64190130
y.create.l HWIO_MSS_UIM0_UART_DM_TF_14_ADDR A:0x64190134
y.create.l HWIO_MSS_UIM0_UART_DM_TF_15_ADDR A:0x64190138
y.create.l HWIO_MSS_UIM0_UART_DM_TF_16_ADDR A:0x6419013c
y.create.l HWIO_MSS_UIM0_UART_DM_RF_ADDR A:0x64190140
y.create.l HWIO_MSS_UIM0_UART_DM_RF_2_ADDR A:0x64190144
y.create.l HWIO_MSS_UIM0_UART_DM_RF_3_ADDR A:0x64190148
y.create.l HWIO_MSS_UIM0_UART_DM_RF_4_ADDR A:0x6419014c
y.create.l HWIO_MSS_UIM0_UART_DM_RF_5_ADDR A:0x64190150
y.create.l HWIO_MSS_UIM0_UART_DM_RF_6_ADDR A:0x64190154
y.create.l HWIO_MSS_UIM0_UART_DM_RF_7_ADDR A:0x64190158
y.create.l HWIO_MSS_UIM0_UART_DM_RF_8_ADDR A:0x6419015c
y.create.l HWIO_MSS_UIM0_UART_DM_RF_9_ADDR A:0x64190160
y.create.l HWIO_MSS_UIM0_UART_DM_RF_10_ADDR A:0x64190164
y.create.l HWIO_MSS_UIM0_UART_DM_RF_11_ADDR A:0x64190168
y.create.l HWIO_MSS_UIM0_UART_DM_RF_12_ADDR A:0x6419016c
y.create.l HWIO_MSS_UIM0_UART_DM_RF_13_ADDR A:0x64190170
y.create.l HWIO_MSS_UIM0_UART_DM_RF_14_ADDR A:0x64190174
y.create.l HWIO_MSS_UIM0_UART_DM_RF_15_ADDR A:0x64190178
y.create.l HWIO_MSS_UIM0_UART_DM_RF_16_ADDR A:0x6419017c
y.create.l HWIO_MSS_UIM0_UART_DM_UIM_CFG_ADDR A:0x64190180
y.create.l HWIO_MSS_UIM0_UART_DM_UIM_CMD_ADDR A:0x64190184
y.create.l HWIO_MSS_UIM0_UART_DM_UIM_IO_STATUS_ADDR A:0x64190188
y.create.l HWIO_MSS_UIM0_UART_DM_UIM_IRQ_ISR_ADDR A:0x6419018c
y.create.l HWIO_MSS_UIM0_UART_DM_UIM_IRQ_MISR_ADDR A:0x64190190
y.create.l HWIO_MSS_UIM0_UART_DM_UIM_IRQ_CLR_ADDR A:0x64190194
y.create.l HWIO_MSS_UIM0_UART_DM_UIM_IRQ_IMR_ADDR A:0x64190198
y.create.l HWIO_MSS_UIM0_UART_DM_UIM_IRQ_IMR_SET_ADDR A:0x6419019c
y.create.l HWIO_MSS_UIM0_UART_DM_UIM_IRQ_IMR_CLR_ADDR A:0x641901a0
y.create.l HWIO_MSS_UIM1_UART_DM_MR1_ADDR A:0x64198000
y.create.l HWIO_MSS_UIM1_UART_DM_MR2_ADDR A:0x64198004
y.create.l HWIO_MSS_UIM1_UART_DM_CSR_SR_DEPRECATED_ADDR A:0x64198008
y.create.l HWIO_MSS_UIM1_UART_DM_CR_MISR_DEPRECATED_ADDR A:0x64198010
y.create.l HWIO_MSS_UIM1_UART_DM_IMR_ISR_DEPRECATED_ADDR A:0x64198014
y.create.l HWIO_MSS_UIM1_UART_DM_IPR_ADDR A:0x64198018
y.create.l HWIO_MSS_UIM1_UART_DM_TFWR_ADDR A:0x6419801c
y.create.l HWIO_MSS_UIM1_UART_DM_RFWR_ADDR A:0x64198020
y.create.l HWIO_MSS_UIM1_UART_DM_HCR_ADDR A:0x64198024
y.create.l HWIO_MSS_UIM1_UART_DM_DMRX_ADDR A:0x64198034
y.create.l HWIO_MSS_UIM1_UART_DM_IRDA_RX_TOTAL_SNAP_DEPRECATED_ADDR A:0x64198038
y.create.l HWIO_MSS_UIM1_UART_DM_DMEN_ADDR A:0x6419803c
y.create.l HWIO_MSS_UIM1_UART_DM_NO_CHARS_FOR_TX_ADDR A:0x64198040
y.create.l HWIO_MSS_UIM1_UART_DM_BADR_ADDR A:0x64198044
y.create.l HWIO_MSS_UIM1_UART_DM_TESTSL_ADDR A:0x64198048
y.create.l HWIO_MSS_UIM1_UART_DM_TXFS_ADDR A:0x6419804c
y.create.l HWIO_MSS_UIM1_UART_DM_RXFS_ADDR A:0x64198050
y.create.l HWIO_MSS_UIM1_UART_DM_MISR_MODE_ADDR A:0x64198060
y.create.l HWIO_MSS_UIM1_UART_DM_MISR_RESET_ADDR A:0x64198064
y.create.l HWIO_MSS_UIM1_UART_DM_MISR_EXPORT_ADDR A:0x64198068
y.create.l HWIO_MSS_UIM1_UART_DM_MISR_VAL_ADDR A:0x6419806c
y.create.l HWIO_MSS_UIM1_UART_DM_TF_RF_DEPRECATED_ADDR A:0x64198070
y.create.l HWIO_MSS_UIM1_UART_DM_TF_RF_2_DEPRECATED_ADDR A:0x64198074
y.create.l HWIO_MSS_UIM1_UART_DM_TF_RF_3_DEPRECATED_ADDR A:0x64198078
y.create.l HWIO_MSS_UIM1_UART_DM_TF_RF_4_DEPRECATED_ADDR A:0x6419807c
y.create.l HWIO_MSS_UIM1_UART_DM_SIM_CFG_ADDR A:0x64198080
y.create.l HWIO_MSS_UIM1_UART_DM_TEST_WR_ADDR_ADDR A:0x64198084
y.create.l HWIO_MSS_UIM1_UART_DM_TEST_WR_DATA_ADDR A:0x64198088
y.create.l HWIO_MSS_UIM1_UART_DM_TEST_RD_ADDR_ADDR A:0x6419808c
y.create.l HWIO_MSS_UIM1_UART_DM_TEST_RD_DATA_ADDR A:0x64198090
y.create.l HWIO_MSS_UIM1_UART_DM_CSR_ADDR A:0x641980a0
y.create.l HWIO_MSS_UIM1_UART_DM_SR_ADDR A:0x641980a4
y.create.l HWIO_MSS_UIM1_UART_DM_CR_ADDR A:0x641980a8
y.create.l HWIO_MSS_UIM1_UART_DM_MISR_ADDR A:0x641980ac
y.create.l HWIO_MSS_UIM1_UART_DM_IMR_ADDR A:0x641980b0
y.create.l HWIO_MSS_UIM1_UART_DM_ISR_ADDR A:0x641980b4
y.create.l HWIO_MSS_UIM1_UART_DM_IRDA_ADDR A:0x641980b8
y.create.l HWIO_MSS_UIM1_UART_DM_RX_TOTAL_SNAP_ADDR A:0x641980bc
y.create.l HWIO_MSS_UIM1_UART_DM_WWT_TIMEOUT_ADDR A:0x641980c0
y.create.l HWIO_MSS_UIM1_UART_DM_CLK_CTRL_ADDR A:0x641980c4
y.create.l HWIO_MSS_UIM1_UART_DM_BCR_ADDR A:0x641980c8
y.create.l HWIO_MSS_UIM1_UART_DM_RX_TRANS_CTRL_ADDR A:0x641980cc
y.create.l HWIO_MSS_UIM1_UART_DM_DMRX_DBG_ADDR A:0x641980d0
y.create.l HWIO_MSS_UIM1_UART_DM_FSM_STATUS_ADDR A:0x641980d4
y.create.l HWIO_MSS_UIM1_UART_DM_HW_VERSION_ADDR A:0x641980d8
y.create.l HWIO_MSS_UIM1_UART_DM_GENERICS_ADDR A:0x641980dc
y.create.l HWIO_MSS_UIM1_UART_DM_TF_ADDR A:0x64198100
y.create.l HWIO_MSS_UIM1_UART_DM_TF_2_ADDR A:0x64198104
y.create.l HWIO_MSS_UIM1_UART_DM_TF_3_ADDR A:0x64198108
y.create.l HWIO_MSS_UIM1_UART_DM_TF_4_ADDR A:0x6419810c
y.create.l HWIO_MSS_UIM1_UART_DM_TF_5_ADDR A:0x64198110
y.create.l HWIO_MSS_UIM1_UART_DM_TF_6_ADDR A:0x64198114
y.create.l HWIO_MSS_UIM1_UART_DM_TF_7_ADDR A:0x64198118
y.create.l HWIO_MSS_UIM1_UART_DM_TF_8_ADDR A:0x6419811c
y.create.l HWIO_MSS_UIM1_UART_DM_TF_9_ADDR A:0x64198120
y.create.l HWIO_MSS_UIM1_UART_DM_TF_10_ADDR A:0x64198124
y.create.l HWIO_MSS_UIM1_UART_DM_TF_11_ADDR A:0x64198128
y.create.l HWIO_MSS_UIM1_UART_DM_TF_12_ADDR A:0x6419812c
y.create.l HWIO_MSS_UIM1_UART_DM_TF_13_ADDR A:0x64198130
y.create.l HWIO_MSS_UIM1_UART_DM_TF_14_ADDR A:0x64198134
y.create.l HWIO_MSS_UIM1_UART_DM_TF_15_ADDR A:0x64198138
y.create.l HWIO_MSS_UIM1_UART_DM_TF_16_ADDR A:0x6419813c
y.create.l HWIO_MSS_UIM1_UART_DM_RF_ADDR A:0x64198140
y.create.l HWIO_MSS_UIM1_UART_DM_RF_2_ADDR A:0x64198144
y.create.l HWIO_MSS_UIM1_UART_DM_RF_3_ADDR A:0x64198148
y.create.l HWIO_MSS_UIM1_UART_DM_RF_4_ADDR A:0x6419814c
y.create.l HWIO_MSS_UIM1_UART_DM_RF_5_ADDR A:0x64198150
y.create.l HWIO_MSS_UIM1_UART_DM_RF_6_ADDR A:0x64198154
y.create.l HWIO_MSS_UIM1_UART_DM_RF_7_ADDR A:0x64198158
y.create.l HWIO_MSS_UIM1_UART_DM_RF_8_ADDR A:0x6419815c
y.create.l HWIO_MSS_UIM1_UART_DM_RF_9_ADDR A:0x64198160
y.create.l HWIO_MSS_UIM1_UART_DM_RF_10_ADDR A:0x64198164
y.create.l HWIO_MSS_UIM1_UART_DM_RF_11_ADDR A:0x64198168
y.create.l HWIO_MSS_UIM1_UART_DM_RF_12_ADDR A:0x6419816c
y.create.l HWIO_MSS_UIM1_UART_DM_RF_13_ADDR A:0x64198170
y.create.l HWIO_MSS_UIM1_UART_DM_RF_14_ADDR A:0x64198174
y.create.l HWIO_MSS_UIM1_UART_DM_RF_15_ADDR A:0x64198178
y.create.l HWIO_MSS_UIM1_UART_DM_RF_16_ADDR A:0x6419817c
y.create.l HWIO_MSS_UIM1_UART_DM_UIM_CFG_ADDR A:0x64198180
y.create.l HWIO_MSS_UIM1_UART_DM_UIM_CMD_ADDR A:0x64198184
y.create.l HWIO_MSS_UIM1_UART_DM_UIM_IO_STATUS_ADDR A:0x64198188
y.create.l HWIO_MSS_UIM1_UART_DM_UIM_IRQ_ISR_ADDR A:0x6419818c
y.create.l HWIO_MSS_UIM1_UART_DM_UIM_IRQ_MISR_ADDR A:0x64198190
y.create.l HWIO_MSS_UIM1_UART_DM_UIM_IRQ_CLR_ADDR A:0x64198194
y.create.l HWIO_MSS_UIM1_UART_DM_UIM_IRQ_IMR_ADDR A:0x64198198
y.create.l HWIO_MSS_UIM1_UART_DM_UIM_IRQ_IMR_SET_ADDR A:0x6419819c
y.create.l HWIO_MSS_UIM1_UART_DM_UIM_IRQ_IMR_CLR_ADDR A:0x641981a0
y.create.l HWIO_MSS_UIM2_UART_DM_MR1_ADDR A:0x641a8000
y.create.l HWIO_MSS_UIM2_UART_DM_MR2_ADDR A:0x641a8004
y.create.l HWIO_MSS_UIM2_UART_DM_CSR_SR_DEPRECATED_ADDR A:0x641a8008
y.create.l HWIO_MSS_UIM2_UART_DM_CR_MISR_DEPRECATED_ADDR A:0x641a8010
y.create.l HWIO_MSS_UIM2_UART_DM_IMR_ISR_DEPRECATED_ADDR A:0x641a8014
y.create.l HWIO_MSS_UIM2_UART_DM_IPR_ADDR A:0x641a8018
y.create.l HWIO_MSS_UIM2_UART_DM_TFWR_ADDR A:0x641a801c
y.create.l HWIO_MSS_UIM2_UART_DM_RFWR_ADDR A:0x641a8020
y.create.l HWIO_MSS_UIM2_UART_DM_HCR_ADDR A:0x641a8024
y.create.l HWIO_MSS_UIM2_UART_DM_DMRX_ADDR A:0x641a8034
y.create.l HWIO_MSS_UIM2_UART_DM_IRDA_RX_TOTAL_SNAP_DEPRECATED_ADDR A:0x641a8038
y.create.l HWIO_MSS_UIM2_UART_DM_DMEN_ADDR A:0x641a803c
y.create.l HWIO_MSS_UIM2_UART_DM_NO_CHARS_FOR_TX_ADDR A:0x641a8040
y.create.l HWIO_MSS_UIM2_UART_DM_BADR_ADDR A:0x641a8044
y.create.l HWIO_MSS_UIM2_UART_DM_TESTSL_ADDR A:0x641a8048
y.create.l HWIO_MSS_UIM2_UART_DM_TXFS_ADDR A:0x641a804c
y.create.l HWIO_MSS_UIM2_UART_DM_RXFS_ADDR A:0x641a8050
y.create.l HWIO_MSS_UIM2_UART_DM_MISR_MODE_ADDR A:0x641a8060
y.create.l HWIO_MSS_UIM2_UART_DM_MISR_RESET_ADDR A:0x641a8064
y.create.l HWIO_MSS_UIM2_UART_DM_MISR_EXPORT_ADDR A:0x641a8068
y.create.l HWIO_MSS_UIM2_UART_DM_MISR_VAL_ADDR A:0x641a806c
y.create.l HWIO_MSS_UIM2_UART_DM_TF_RF_DEPRECATED_ADDR A:0x641a8070
y.create.l HWIO_MSS_UIM2_UART_DM_TF_RF_2_DEPRECATED_ADDR A:0x641a8074
y.create.l HWIO_MSS_UIM2_UART_DM_TF_RF_3_DEPRECATED_ADDR A:0x641a8078
y.create.l HWIO_MSS_UIM2_UART_DM_TF_RF_4_DEPRECATED_ADDR A:0x641a807c
y.create.l HWIO_MSS_UIM2_UART_DM_SIM_CFG_ADDR A:0x641a8080
y.create.l HWIO_MSS_UIM2_UART_DM_TEST_WR_ADDR_ADDR A:0x641a8084
y.create.l HWIO_MSS_UIM2_UART_DM_TEST_WR_DATA_ADDR A:0x641a8088
y.create.l HWIO_MSS_UIM2_UART_DM_TEST_RD_ADDR_ADDR A:0x641a808c
y.create.l HWIO_MSS_UIM2_UART_DM_TEST_RD_DATA_ADDR A:0x641a8090
y.create.l HWIO_MSS_UIM2_UART_DM_CSR_ADDR A:0x641a80a0
y.create.l HWIO_MSS_UIM2_UART_DM_SR_ADDR A:0x641a80a4
y.create.l HWIO_MSS_UIM2_UART_DM_CR_ADDR A:0x641a80a8
y.create.l HWIO_MSS_UIM2_UART_DM_MISR_ADDR A:0x641a80ac
y.create.l HWIO_MSS_UIM2_UART_DM_IMR_ADDR A:0x641a80b0
y.create.l HWIO_MSS_UIM2_UART_DM_ISR_ADDR A:0x641a80b4
y.create.l HWIO_MSS_UIM2_UART_DM_IRDA_ADDR A:0x641a80b8
y.create.l HWIO_MSS_UIM2_UART_DM_RX_TOTAL_SNAP_ADDR A:0x641a80bc
y.create.l HWIO_MSS_UIM2_UART_DM_WWT_TIMEOUT_ADDR A:0x641a80c0
y.create.l HWIO_MSS_UIM2_UART_DM_CLK_CTRL_ADDR A:0x641a80c4
y.create.l HWIO_MSS_UIM2_UART_DM_BCR_ADDR A:0x641a80c8
y.create.l HWIO_MSS_UIM2_UART_DM_RX_TRANS_CTRL_ADDR A:0x641a80cc
y.create.l HWIO_MSS_UIM2_UART_DM_DMRX_DBG_ADDR A:0x641a80d0
y.create.l HWIO_MSS_UIM2_UART_DM_FSM_STATUS_ADDR A:0x641a80d4
y.create.l HWIO_MSS_UIM2_UART_DM_HW_VERSION_ADDR A:0x641a80d8
y.create.l HWIO_MSS_UIM2_UART_DM_GENERICS_ADDR A:0x641a80dc
y.create.l HWIO_MSS_UIM2_UART_DM_TF_ADDR A:0x641a8100
y.create.l HWIO_MSS_UIM2_UART_DM_TF_2_ADDR A:0x641a8104
y.create.l HWIO_MSS_UIM2_UART_DM_TF_3_ADDR A:0x641a8108
y.create.l HWIO_MSS_UIM2_UART_DM_TF_4_ADDR A:0x641a810c
y.create.l HWIO_MSS_UIM2_UART_DM_TF_5_ADDR A:0x641a8110
y.create.l HWIO_MSS_UIM2_UART_DM_TF_6_ADDR A:0x641a8114
y.create.l HWIO_MSS_UIM2_UART_DM_TF_7_ADDR A:0x641a8118
y.create.l HWIO_MSS_UIM2_UART_DM_TF_8_ADDR A:0x641a811c
y.create.l HWIO_MSS_UIM2_UART_DM_TF_9_ADDR A:0x641a8120
y.create.l HWIO_MSS_UIM2_UART_DM_TF_10_ADDR A:0x641a8124
y.create.l HWIO_MSS_UIM2_UART_DM_TF_11_ADDR A:0x641a8128
y.create.l HWIO_MSS_UIM2_UART_DM_TF_12_ADDR A:0x641a812c
y.create.l HWIO_MSS_UIM2_UART_DM_TF_13_ADDR A:0x641a8130
y.create.l HWIO_MSS_UIM2_UART_DM_TF_14_ADDR A:0x641a8134
y.create.l HWIO_MSS_UIM2_UART_DM_TF_15_ADDR A:0x641a8138
y.create.l HWIO_MSS_UIM2_UART_DM_TF_16_ADDR A:0x641a813c
y.create.l HWIO_MSS_UIM2_UART_DM_RF_ADDR A:0x641a8140
y.create.l HWIO_MSS_UIM2_UART_DM_RF_2_ADDR A:0x641a8144
y.create.l HWIO_MSS_UIM2_UART_DM_RF_3_ADDR A:0x641a8148
y.create.l HWIO_MSS_UIM2_UART_DM_RF_4_ADDR A:0x641a814c
y.create.l HWIO_MSS_UIM2_UART_DM_RF_5_ADDR A:0x641a8150
y.create.l HWIO_MSS_UIM2_UART_DM_RF_6_ADDR A:0x641a8154
y.create.l HWIO_MSS_UIM2_UART_DM_RF_7_ADDR A:0x641a8158
y.create.l HWIO_MSS_UIM2_UART_DM_RF_8_ADDR A:0x641a815c
y.create.l HWIO_MSS_UIM2_UART_DM_RF_9_ADDR A:0x641a8160
y.create.l HWIO_MSS_UIM2_UART_DM_RF_10_ADDR A:0x641a8164
y.create.l HWIO_MSS_UIM2_UART_DM_RF_11_ADDR A:0x641a8168
y.create.l HWIO_MSS_UIM2_UART_DM_RF_12_ADDR A:0x641a816c
y.create.l HWIO_MSS_UIM2_UART_DM_RF_13_ADDR A:0x641a8170
y.create.l HWIO_MSS_UIM2_UART_DM_RF_14_ADDR A:0x641a8174
y.create.l HWIO_MSS_UIM2_UART_DM_RF_15_ADDR A:0x641a8178
y.create.l HWIO_MSS_UIM2_UART_DM_RF_16_ADDR A:0x641a817c
y.create.l HWIO_MSS_UIM2_UART_DM_UIM_CFG_ADDR A:0x641a8180
y.create.l HWIO_MSS_UIM2_UART_DM_UIM_CMD_ADDR A:0x641a8184
y.create.l HWIO_MSS_UIM2_UART_DM_UIM_IO_STATUS_ADDR A:0x641a8188
y.create.l HWIO_MSS_UIM2_UART_DM_UIM_IRQ_ISR_ADDR A:0x641a818c
y.create.l HWIO_MSS_UIM2_UART_DM_UIM_IRQ_MISR_ADDR A:0x641a8190
y.create.l HWIO_MSS_UIM2_UART_DM_UIM_IRQ_CLR_ADDR A:0x641a8194
y.create.l HWIO_MSS_UIM2_UART_DM_UIM_IRQ_IMR_ADDR A:0x641a8198
y.create.l HWIO_MSS_UIM2_UART_DM_UIM_IRQ_IMR_SET_ADDR A:0x641a819c
y.create.l HWIO_MSS_UIM2_UART_DM_UIM_IRQ_IMR_CLR_ADDR A:0x641a81a0
y.create.l HWIO_MSS_CONF_ABT_HW_VERSION_ADDR A:0x641b0000
y.create.l HWIO_MSS_CONF_ABT_INST_ID_ADDR A:0x641b0004
y.create.l HWIO_MSS_CONF_ABT_NUM_SLAVES_ADDR A:0x641b0008
y.create.l HWIO_MSS_CONF_ABT_TIMER_LOADVAL_ADDR A:0x641b000c
y.create.l HWIO_MSS_CONF_ABT_TIMER_MODE_ADDR A:0x641b0010
y.create.l HWIO_MSS_CONF_ABT_INTR_STATUS_ADDR A:0x641b0014
y.create.l HWIO_MSS_CONF_ABT_INTR_CLEAR_ADDR A:0x641b0018
y.create.l HWIO_MSS_CONF_ABT_INTR_ENABLE_ADDR A:0x641b001c
y.create.l HWIO_MSS_CONF_ABT_SYND_VALID_ADDR A:0x641b0020
y.create.l HWIO_MSS_CONF_ABT_SYND_CLEAR_ADDR A:0x641b0024
y.create.l HWIO_MSS_CONF_ABT_SYND_ID_ADDR A:0x641b0028
y.create.l HWIO_MSS_CONF_ABT_SYND_ADDR0_ADDR A:0x641b002c
y.create.l HWIO_MSS_CONF_ABT_SYND_ADDR1_ADDR A:0x641b0030
y.create.l HWIO_MSS_CONF_ABT_SYND_HREADY_ADDR A:0x641b0034
y.create.l HWIO_COMBODAC_CFG0_0_ADDR A:0x641b2000
y.create.l HWIO_COMBODAC_CFG1_0_ADDR A:0x641b2008
y.create.l HWIO_COMBODAC_CFG2_0_ADDR A:0x641b2010
y.create.l HWIO_COMBODAC_DIGVAL_EN_0_ADDR A:0x641b2020
y.create.l HWIO_COMBODAC_IREF_CTRL_0_ADDR A:0x641b2028
y.create.l HWIO_COMBODAC_CAL_CTRL_0_ADDR A:0x641b2030
y.create.l HWIO_COMBODAC_CAL_STATUS_0_ADDR A:0x641b2038
y.create.l HWIO_COMBODAC_MEM_RW_CTRL_0_ADDR A:0x641b2040
y.create.l HWIO_COMBODAC_MEM_RD_DATA_0_ADDR A:0x641b2048
y.create.l HWIO_COMBODAC_RTUNE_RW_CTRL_0_ADDR A:0x641b2050
y.create.l HWIO_COMBODAC_RTUNE_RD_DATA_0_ADDR A:0x641b2058
y.create.l HWIO_COMBODAC_DEBUG_INR_0_ADDR A:0x641b2060
y.create.l HWIO_COMBODAC_DEBUG_OUTR_0_ADDR A:0x641b2068
y.create.l HWIO_COMBODAC_DEBUG_ING_0_ADDR A:0x641b2070
y.create.l HWIO_COMBODAC_DEBUG_OUTG_0_ADDR A:0x641b2078
y.create.l HWIO_COMBODAC_TEST_CTRL_0_ADDR A:0x641b2080
y.create.l HWIO_COMBODAC_COMP_CMDS_ADDR A:0x641b2090
y.create.l HWIO_COMBODAC_COMP_STATUS_ADDR A:0x641b2094
y.create.l HWIO_COMBODAC_BIST_CFG_ADDR A:0x641b2098
y.create.l HWIO_COMBODAC_COMP_CTRL_ADDR A:0x641b209c
y.create.l HWIO_COMBODAC0_CLK_CFG_ADDR A:0x641b20a0
y.create.l HWIO_COMBODAC1_CLK_CFG_ADDR A:0x641b20a4
y.create.l HWIO_COMBODAC_CLK_SRC_CFG_ADDR A:0x641b20a8
y.create.l HWIO_COMBODAC_TIME_CYCLE_ADDR A:0x641b20ac
y.create.l HWIO_COMBODAC_FSM_STATE_MONIT_ADDR A:0x641b20b0
y.create.l HWIO_COMBODAC_IREF_STATUS_ADDR A:0x641b20b4
y.create.l HWIO_COMBODAC_REGARRAY0_ADDR A:0x641b2800
y.create.l HWIO_COMBODAC_REGARRAY1_ADDR A:0x641b2804
y.create.l HWIO_COMBODAC_REGARRAY2_ADDR A:0x641b2808
y.create.l HWIO_COMBODAC_REGARRAY3_ADDR A:0x641b280c
y.create.l HWIO_COMBODAC_REGARRAY4_ADDR A:0x641b2810
y.create.l HWIO_COMBODAC_REGARRAY5_ADDR A:0x641b2814
y.create.l HWIO_COMBODAC_REGARRAY6_ADDR A:0x641b2818
y.create.l HWIO_COMBODAC_REGARRAY7_ADDR A:0x641b281c
y.create.l HWIO_COMBODAC_REGARRAY8_ADDR A:0x641b2820
y.create.l HWIO_COMBODAC_REGARRAY9_ADDR A:0x641b2824
y.create.l HWIO_MSS_MGPI_PMIC_CONFIG0_ADDR A:0x641b3000
y.create.l HWIO_MSS_MGPI_PMIC_CONFIG1_ADDR A:0x641b3008
y.create.l HWIO_MSS_MGPI_PMIC_CONFIG2_ADDR A:0x641b3010
y.create.l HWIO_MSS_MGPI_PMIC_CONFIG3_ADDR A:0x641b3018
y.create.l HWIO_MSS_MGPI_PMIC_CONFIG4_ADDR A:0x641b3020
y.create.l HWIO_MSS_MGPI_PMIC_CONFIG5_ADDR A:0x641b3028
y.create.l HWIO_MSS_MGPI_PMIC_CONFIG6_ADDR A:0x641b3030
y.create.l HWIO_MSS_MGPI_PMIC_CONFIG7_ADDR A:0x641b3038
y.create.l HWIO_MSS_MGPI_PMIC_CONFIG8_ADDR A:0x641b3040
y.create.l HWIO_MSS_MGPI_PMIC_CONFIG9_ADDR A:0x641b3048
y.create.l HWIO_MSS_MGPI_CONF_STATUS0_ADDR A:0x641b3004
y.create.l HWIO_MSS_MGPI_CONF_STATUS1_ADDR A:0x641b300c
y.create.l HWIO_MSS_MGPI_CONF_STATUS2_ADDR A:0x641b3014
y.create.l HWIO_MSS_MGPI_CONF_STATUS3_ADDR A:0x641b301c
y.create.l HWIO_MSS_MGPI_CONF_STATUS4_ADDR A:0x641b3024
y.create.l HWIO_MSS_MGPI_CONF_STATUS5_ADDR A:0x641b302c
y.create.l HWIO_MSS_MGPI_CONF_STATUS6_ADDR A:0x641b3034
y.create.l HWIO_MSS_MGPI_CONF_STATUS7_ADDR A:0x641b303c
y.create.l HWIO_MSS_MGPI_CONF_STATUS8_ADDR A:0x641b3044
y.create.l HWIO_MSS_MGPI_CONF_STATUS9_ADDR A:0x641b304c
y.create.l HWIO_MSS_MGPI_MASTER_CSR_ADDR A:0x641b3100
y.create.l HWIO_MSS_MGPI_HW_VERSION_ADDR A:0x641b3104
y.create.l HWIO_MSS_CRYPTO_VERSION_ADDR A:0x641fa000
y.create.l HWIO_MSS_CRYPTO_DATA_IN0_ADDR A:0x641fa010
y.create.l HWIO_MSS_CRYPTO_DATA_IN1_ADDR A:0x641fa014
y.create.l HWIO_MSS_CRYPTO_DATA_IN2_ADDR A:0x641fa018
y.create.l HWIO_MSS_CRYPTO_DATA_IN3_ADDR A:0x641fa01c
y.create.l HWIO_MSS_CRYPTO_DATA_OUT0_ADDR A:0x641fa020
y.create.l HWIO_MSS_CRYPTO_DATA_OUT1_ADDR A:0x641fa024
y.create.l HWIO_MSS_CRYPTO_DATA_OUT2_ADDR A:0x641fa028
y.create.l HWIO_MSS_CRYPTO_DATA_OUT3_ADDR A:0x641fa02c
y.create.l HWIO_MSS_CRYPTO_STATUS_ADDR A:0x641fa100
y.create.l HWIO_MSS_CRYPTO_STATUS2_ADDR A:0x641fa104
y.create.l HWIO_MSS_CRYPTO_ENGINES_AVAIL_ADDR A:0x641fa108
y.create.l HWIO_MSS_CRYPTO_FIFO_SIZES_ADDR A:0x641fa10c
y.create.l HWIO_MSS_CRYPTO_SEG_SIZE_ADDR A:0x641fa110
y.create.l HWIO_MSS_CRYPTO_GOPROC_ADDR A:0x641fa120
y.create.l HWIO_MSS_CRYPTO_GOPROC_QC_KEY_ADDR A:0x641fb000
y.create.l HWIO_MSS_CRYPTO_GOPROC_OEM_KEY_ADDR A:0x641fc000
y.create.l HWIO_MSS_CRYPTO_ENCR_SEG_CFG_ADDR A:0x641fa200
y.create.l HWIO_MSS_CRYPTO_ENCR_SEG_SIZE_ADDR A:0x641fa204
y.create.l HWIO_MSS_CRYPTO_ENCR_SEG_START_ADDR A:0x641fa208
y.create.l HWIO_MSS_CRYPTO_ENCR_KEY0_ADDR A:0x641fd000
y.create.l HWIO_MSS_CRYPTO_ENCR_KEY1_ADDR A:0x641fd004
y.create.l HWIO_MSS_CRYPTO_ENCR_KEY2_ADDR A:0x641fd008
y.create.l HWIO_MSS_CRYPTO_ENCR_KEY3_ADDR A:0x641fd00c
y.create.l HWIO_MSS_CRYPTO_ENCR_KEY4_ADDR A:0x641fd010
y.create.l HWIO_MSS_CRYPTO_ENCR_KEY5_ADDR A:0x641fd014
y.create.l HWIO_MSS_CRYPTO_ENCR_KEY6_ADDR A:0x641fd018
y.create.l HWIO_MSS_CRYPTO_ENCR_KEY7_ADDR A:0x641fd01c
y.create.l HWIO_MSS_CRYPTO_ENCR_XTS_KEY0_ADDR A:0x641fd020
y.create.l HWIO_MSS_CRYPTO_ENCR_XTS_KEY1_ADDR A:0x641fd024
y.create.l HWIO_MSS_CRYPTO_ENCR_XTS_KEY2_ADDR A:0x641fd028
y.create.l HWIO_MSS_CRYPTO_ENCR_XTS_KEY3_ADDR A:0x641fd02c
y.create.l HWIO_MSS_CRYPTO_ENCR_XTS_KEY4_ADDR A:0x641fd030
y.create.l HWIO_MSS_CRYPTO_ENCR_XTS_KEY5_ADDR A:0x641fd034
y.create.l HWIO_MSS_CRYPTO_ENCR_XTS_KEY6_ADDR A:0x641fd038
y.create.l HWIO_MSS_CRYPTO_ENCR_XTS_KEY7_ADDR A:0x641fd03c
y.create.l HWIO_MSS_CRYPTO_ENCR_CNTR0_IV0_ADDR A:0x641fa20c
y.create.l HWIO_MSS_CRYPTO_ENCR_CNTR1_IV1_ADDR A:0x641fa210
y.create.l HWIO_MSS_CRYPTO_ENCR_CNTR2_IV2_ADDR A:0x641fa214
y.create.l HWIO_MSS_CRYPTO_ENCR_CNTR3_IV3_ADDR A:0x641fa218
y.create.l HWIO_MSS_CRYPTO_ENCR_CNTR_MASK_ADDR A:0x641fa21c
y.create.l HWIO_MSS_CRYPTO_ENCR_CNTR_MASK2_ADDR A:0x641fa234
y.create.l HWIO_MSS_CRYPTO_ENCR_CNTR_MASK1_ADDR A:0x641fa238
y.create.l HWIO_MSS_CRYPTO_ENCR_CNTR_MASK0_ADDR A:0x641fa23c
y.create.l HWIO_MSS_CRYPTO_ENCR_CCM_INIT_CNTR0_ADDR A:0x641fa220
y.create.l HWIO_MSS_CRYPTO_ENCR_CCM_INIT_CNTR1_ADDR A:0x641fa224
y.create.l HWIO_MSS_CRYPTO_ENCR_CCM_INIT_CNTR2_ADDR A:0x641fa228
y.create.l HWIO_MSS_CRYPTO_ENCR_CCM_INIT_CNTR3_ADDR A:0x641fa22c
y.create.l HWIO_MSS_CRYPTO_ENCR_XTS_DU_SIZE_ADDR A:0x641fa230
y.create.l HWIO_MSS_CRYPTO_AUTH_SEG_CFG_ADDR A:0x641fa300
y.create.l HWIO_MSS_CRYPTO_AUTH_SEG_SIZE_ADDR A:0x641fa304
y.create.l HWIO_MSS_CRYPTO_AUTH_SEG_START_ADDR A:0x641fa308
y.create.l HWIO_MSS_CRYPTO_AUTH_KEY0_ADDR A:0x641fd040
y.create.l HWIO_MSS_CRYPTO_AUTH_KEY1_ADDR A:0x641fd044
y.create.l HWIO_MSS_CRYPTO_AUTH_KEY2_ADDR A:0x641fd048
y.create.l HWIO_MSS_CRYPTO_AUTH_KEY3_ADDR A:0x641fd04c
y.create.l HWIO_MSS_CRYPTO_AUTH_KEY4_ADDR A:0x641fd050
y.create.l HWIO_MSS_CRYPTO_AUTH_KEY5_ADDR A:0x641fd054
y.create.l HWIO_MSS_CRYPTO_AUTH_KEY6_ADDR A:0x641fd058
y.create.l HWIO_MSS_CRYPTO_AUTH_KEY7_ADDR A:0x641fd05c
y.create.l HWIO_MSS_CRYPTO_AUTH_KEY8_ADDR A:0x641fd060
y.create.l HWIO_MSS_CRYPTO_AUTH_KEY9_ADDR A:0x641fd064
y.create.l HWIO_MSS_CRYPTO_AUTH_IV0_ADDR A:0x641fa310
y.create.l HWIO_MSS_CRYPTO_AUTH_IV1_ADDR A:0x641fa314
y.create.l HWIO_MSS_CRYPTO_AUTH_IV2_ADDR A:0x641fa318
y.create.l HWIO_MSS_CRYPTO_AUTH_IV3_ADDR A:0x641fa31c
y.create.l HWIO_MSS_CRYPTO_AUTH_IV4_ADDR A:0x641fa320
y.create.l HWIO_MSS_CRYPTO_AUTH_IV5_ADDR A:0x641fa324
y.create.l HWIO_MSS_CRYPTO_AUTH_IV6_ADDR A:0x641fa328
y.create.l HWIO_MSS_CRYPTO_AUTH_IV7_ADDR A:0x641fa32c
y.create.l HWIO_MSS_CRYPTO_AUTH_INFO_NONCE0_ADDR A:0x641fa350
y.create.l HWIO_MSS_CRYPTO_AUTH_INFO_NONCE1_ADDR A:0x641fa354
y.create.l HWIO_MSS_CRYPTO_AUTH_INFO_NONCE2_ADDR A:0x641fa358
y.create.l HWIO_MSS_CRYPTO_AUTH_INFO_NONCE3_ADDR A:0x641fa35c
y.create.l HWIO_MSS_CRYPTO_AUTH_BYTECNT0_ADDR A:0x641fa390
y.create.l HWIO_MSS_CRYPTO_AUTH_BYTECNT1_ADDR A:0x641fa394
y.create.l HWIO_MSS_CRYPTO_AUTH_EXP_MAC0_ADDR A:0x641fa3a0
y.create.l HWIO_MSS_CRYPTO_AUTH_EXP_MAC1_ADDR A:0x641fa3a4
y.create.l HWIO_MSS_CRYPTO_AUTH_EXP_MAC2_ADDR A:0x641fa3a8
y.create.l HWIO_MSS_CRYPTO_AUTH_EXP_MAC3_ADDR A:0x641fa3ac
y.create.l HWIO_MSS_CRYPTO_AUTH_EXP_MAC4_ADDR A:0x641fa3b0
y.create.l HWIO_MSS_CRYPTO_AUTH_EXP_MAC5_ADDR A:0x641fa3b4
y.create.l HWIO_MSS_CRYPTO_AUTH_EXP_MAC6_ADDR A:0x641fa3b8
y.create.l HWIO_MSS_CRYPTO_AUTH_EXP_MAC7_ADDR A:0x641fa3bc
y.create.l HWIO_MSS_CRYPTO_CONFIG_ADDR A:0x641fa400
y.create.l HWIO_MSS_CRYPTO_DEBUG_ENABLE_ADDR A:0x641ff000
y.create.l HWIO_MSS_CRYPTO_DEBUG_ADDR A:0x641ff004
y.create.l HWIO_MSS_CRYPTO_PWR_CTRL_ADDR A:0x641ff008
y.create.l HWIO_MSS_CRYPTO_BAM_CTRL_ADDR A:0x641c4000
y.create.l HWIO_MSS_CRYPTO_BAM_TIMER_ADDR A:0x641c4040
y.create.l HWIO_MSS_CRYPTO_BAM_TIMER_CTRL_ADDR A:0x641c4044
y.create.l HWIO_MSS_CRYPTO_BAM_DESC_CNT_TRSHLD_ADDR A:0x641c4008
y.create.l HWIO_MSS_CRYPTO_BAM_IRQ_STTS_ADDR A:0x641c4014
y.create.l HWIO_MSS_CRYPTO_BAM_IRQ_CLR_ADDR A:0x641c4018
y.create.l HWIO_MSS_CRYPTO_BAM_IRQ_EN_ADDR A:0x641c401c
y.create.l HWIO_MSS_CRYPTO_BAM_CNFG_BITS_ADDR A:0x641c407c
y.create.l HWIO_MSS_CRYPTO_BAM_REVISION_ADDR A:0x641c5000
y.create.l HWIO_MSS_CRYPTO_BAM_SW_VERSION_ADDR A:0x641c5004
y.create.l HWIO_MSS_CRYPTO_BAM_NUM_PIPES_ADDR A:0x641c5008
y.create.l HWIO_MSS_CRYPTO_BAM_TEST_BUS_SEL_ADDR A:0x641c5010
y.create.l HWIO_MSS_CRYPTO_BAM_TEST_BUS_REG_ADDR A:0x641c5014
y.create.l HWIO_MSS_CRYPTO_BAM_AHB_MASTER_ERR_CTRLS_ADDR A:0x641c5024
y.create.l HWIO_MSS_CRYPTO_BAM_AHB_MASTER_ERR_ADDR_ADDR A:0x641c5028
y.create.l HWIO_MSS_CRYPTO_BAM_AHB_MASTER_ERR_DATA_ADDR A:0x641c502c
y.create.l HWIO_MSS_CRYPTO_BAM_AHB_MASTER_ERR_ADDR_LSB_ADDR A:0x641c5100
y.create.l HWIO_MSS_CRYPTO_BAM_AHB_MASTER_ERR_ADDR_MSB_ADDR A:0x641c5104
y.create.l HWIO_MSS_CRYPTO_BAM_TRUST_REG_ADDR A:0x641c6000
y.create.l HWIO_MSS_CRYPTO_BAM_P_TRUST_REG0_ADDR A:0x641c6020
y.create.l HWIO_MSS_CRYPTO_BAM_P_TRUST_REG1_ADDR A:0x641c6024
y.create.l HWIO_MSS_CRYPTO_BAM_IRQ_SRCS_EE0_ADDR A:0x641c7000
y.create.l HWIO_MSS_CRYPTO_BAM_IRQ_SRCS_EE1_ADDR A:0x641c8000
y.create.l HWIO_MSS_CRYPTO_BAM_IRQ_SRCS_EE2_ADDR A:0x641c9000
y.create.l HWIO_MSS_CRYPTO_BAM_IRQ_SRCS_EE3_ADDR A:0x641ca000
y.create.l HWIO_MSS_CRYPTO_BAM_IRQ_SRCS_EE4_ADDR A:0x641cb000
y.create.l HWIO_MSS_CRYPTO_BAM_IRQ_SRCS_EE5_ADDR A:0x641cc000
y.create.l HWIO_MSS_CRYPTO_BAM_IRQ_SRCS_EE6_ADDR A:0x641cd000
y.create.l HWIO_MSS_CRYPTO_BAM_IRQ_SRCS_EE7_ADDR A:0x641ce000
y.create.l HWIO_MSS_CRYPTO_BAM_IRQ_SRCS_MSK_EE0_ADDR A:0x641c7004
y.create.l HWIO_MSS_CRYPTO_BAM_IRQ_SRCS_MSK_EE1_ADDR A:0x641c8004
y.create.l HWIO_MSS_CRYPTO_BAM_IRQ_SRCS_MSK_EE2_ADDR A:0x641c9004
y.create.l HWIO_MSS_CRYPTO_BAM_IRQ_SRCS_MSK_EE3_ADDR A:0x641ca004
y.create.l HWIO_MSS_CRYPTO_BAM_IRQ_SRCS_MSK_EE4_ADDR A:0x641cb004
y.create.l HWIO_MSS_CRYPTO_BAM_IRQ_SRCS_MSK_EE5_ADDR A:0x641cc004
y.create.l HWIO_MSS_CRYPTO_BAM_IRQ_SRCS_MSK_EE6_ADDR A:0x641cd004
y.create.l HWIO_MSS_CRYPTO_BAM_IRQ_SRCS_MSK_EE7_ADDR A:0x641ce004
y.create.l HWIO_MSS_CRYPTO_BAM_IRQ_SRCS_UNMASKED_EE0_ADDR A:0x641c7008
y.create.l HWIO_MSS_CRYPTO_BAM_IRQ_SRCS_UNMASKED_EE1_ADDR A:0x641c8008
y.create.l HWIO_MSS_CRYPTO_BAM_IRQ_SRCS_UNMASKED_EE2_ADDR A:0x641c9008
y.create.l HWIO_MSS_CRYPTO_BAM_IRQ_SRCS_UNMASKED_EE3_ADDR A:0x641ca008
y.create.l HWIO_MSS_CRYPTO_BAM_IRQ_SRCS_UNMASKED_EE4_ADDR A:0x641cb008
y.create.l HWIO_MSS_CRYPTO_BAM_IRQ_SRCS_UNMASKED_EE5_ADDR A:0x641cc008
y.create.l HWIO_MSS_CRYPTO_BAM_IRQ_SRCS_UNMASKED_EE6_ADDR A:0x641cd008
y.create.l HWIO_MSS_CRYPTO_BAM_IRQ_SRCS_UNMASKED_EE7_ADDR A:0x641ce008
y.create.l HWIO_MSS_CRYPTO_BAM_PIPE_ATTR_EE0_ADDR A:0x641c700c
y.create.l HWIO_MSS_CRYPTO_BAM_PIPE_ATTR_EE1_ADDR A:0x641c800c
y.create.l HWIO_MSS_CRYPTO_BAM_PIPE_ATTR_EE2_ADDR A:0x641c900c
y.create.l HWIO_MSS_CRYPTO_BAM_PIPE_ATTR_EE3_ADDR A:0x641ca00c
y.create.l HWIO_MSS_CRYPTO_BAM_PIPE_ATTR_EE4_ADDR A:0x641cb00c
y.create.l HWIO_MSS_CRYPTO_BAM_PIPE_ATTR_EE5_ADDR A:0x641cc00c
y.create.l HWIO_MSS_CRYPTO_BAM_PIPE_ATTR_EE6_ADDR A:0x641cd00c
y.create.l HWIO_MSS_CRYPTO_BAM_PIPE_ATTR_EE7_ADDR A:0x641ce00c
y.create.l HWIO_MSS_CRYPTO_BAM_IRQ_SRCS_ADDR A:0x641c7010
y.create.l HWIO_MSS_CRYPTO_BAM_IRQ_SRCS_MSK_ADDR A:0x641c7014
y.create.l HWIO_MSS_CRYPTO_BAM_IRQ_SRCS_UNMASKED_ADDR A:0x641c7018
y.create.l HWIO_MSS_CRYPTO_BAM_P_CTRL0_ADDR A:0x641d7000
y.create.l HWIO_MSS_CRYPTO_BAM_P_CTRL1_ADDR A:0x641d8000
y.create.l HWIO_MSS_CRYPTO_BAM_P_RST0_ADDR A:0x641d7004
y.create.l HWIO_MSS_CRYPTO_BAM_P_RST1_ADDR A:0x641d8004
y.create.l HWIO_MSS_CRYPTO_BAM_P_HALT0_ADDR A:0x641d7008
y.create.l HWIO_MSS_CRYPTO_BAM_P_HALT1_ADDR A:0x641d8008
y.create.l HWIO_MSS_CRYPTO_BAM_P_IRQ_STTS0_ADDR A:0x641d7010
y.create.l HWIO_MSS_CRYPTO_BAM_P_IRQ_STTS1_ADDR A:0x641d8010
y.create.l HWIO_MSS_CRYPTO_BAM_P_IRQ_CLR0_ADDR A:0x641d7014
y.create.l HWIO_MSS_CRYPTO_BAM_P_IRQ_CLR1_ADDR A:0x641d8014
y.create.l HWIO_MSS_CRYPTO_BAM_P_IRQ_EN0_ADDR A:0x641d7018
y.create.l HWIO_MSS_CRYPTO_BAM_P_IRQ_EN1_ADDR A:0x641d8018
y.create.l HWIO_MSS_CRYPTO_BAM_P_TIMER0_ADDR A:0x641d701c
y.create.l HWIO_MSS_CRYPTO_BAM_P_TIMER1_ADDR A:0x641d801c
y.create.l HWIO_MSS_CRYPTO_BAM_P_TIMER_CTRL0_ADDR A:0x641d7020
y.create.l HWIO_MSS_CRYPTO_BAM_P_TIMER_CTRL1_ADDR A:0x641d8020
y.create.l HWIO_MSS_CRYPTO_BAM_P_PRDCR_SDBND0_ADDR A:0x641d7024
y.create.l HWIO_MSS_CRYPTO_BAM_P_PRDCR_SDBND1_ADDR A:0x641d8024
y.create.l HWIO_MSS_CRYPTO_BAM_P_CNSMR_SDBND0_ADDR A:0x641d7028
y.create.l HWIO_MSS_CRYPTO_BAM_P_CNSMR_SDBND1_ADDR A:0x641d8028
y.create.l HWIO_MSS_CRYPTO_BAM_P_SW_OFSTS0_ADDR A:0x641d7800
y.create.l HWIO_MSS_CRYPTO_BAM_P_SW_OFSTS1_ADDR A:0x641d8800
y.create.l HWIO_MSS_CRYPTO_BAM_P_AU_PSM_CNTXT_1_0_ADDR A:0x641d7804
y.create.l HWIO_MSS_CRYPTO_BAM_P_AU_PSM_CNTXT_1_1_ADDR A:0x641d8804
y.create.l HWIO_MSS_CRYPTO_BAM_P_PSM_CNTXT_2_0_ADDR A:0x641d7808
y.create.l HWIO_MSS_CRYPTO_BAM_P_PSM_CNTXT_2_1_ADDR A:0x641d8808
y.create.l HWIO_MSS_CRYPTO_BAM_P_PSM_CNTXT_3_0_ADDR A:0x641d780c
y.create.l HWIO_MSS_CRYPTO_BAM_P_PSM_CNTXT_3_1_ADDR A:0x641d880c
y.create.l HWIO_MSS_CRYPTO_BAM_P_PSM_CNTXT_4_0_ADDR A:0x641d7810
y.create.l HWIO_MSS_CRYPTO_BAM_P_PSM_CNTXT_4_1_ADDR A:0x641d8810
y.create.l HWIO_MSS_CRYPTO_BAM_P_PSM_CNTXT_5_0_ADDR A:0x641d7814
y.create.l HWIO_MSS_CRYPTO_BAM_P_PSM_CNTXT_5_1_ADDR A:0x641d8814
y.create.l HWIO_MSS_CRYPTO_BAM_P_EVNT_REG0_ADDR A:0x641d7818
y.create.l HWIO_MSS_CRYPTO_BAM_P_EVNT_REG1_ADDR A:0x641d8818
y.create.l HWIO_MSS_CRYPTO_BAM_P_DESC_FIFO_ADDR0_ADDR A:0x641d781c
y.create.l HWIO_MSS_CRYPTO_BAM_P_DESC_FIFO_ADDR1_ADDR A:0x641d881c
y.create.l HWIO_MSS_CRYPTO_BAM_P_FIFO_SIZES0_ADDR A:0x641d7820
y.create.l HWIO_MSS_CRYPTO_BAM_P_FIFO_SIZES1_ADDR A:0x641d8820
y.create.l HWIO_MSS_CRYPTO_BAM_P_DATA_FIFO_ADDR0_ADDR A:0x641d7824
y.create.l HWIO_MSS_CRYPTO_BAM_P_DATA_FIFO_ADDR1_ADDR A:0x641d8824
y.create.l HWIO_MSS_CRYPTO_BAM_P_EVNT_GEN_TRSHLD0_ADDR A:0x641d7828
y.create.l HWIO_MSS_CRYPTO_BAM_P_EVNT_GEN_TRSHLD1_ADDR A:0x641d8828
y.create.l HWIO_MSS_CRYPTO_BAM_P_EVNT_DEST_ADDR0_ADDR A:0x641d782c
y.create.l HWIO_MSS_CRYPTO_BAM_P_EVNT_DEST_ADDR1_ADDR A:0x641d882c
y.create.l HWIO_MSS_CRYPTO_BAM_P_DF_CNTXT_0_ADDR A:0x641d7830
y.create.l HWIO_MSS_CRYPTO_BAM_P_DF_CNTXT_1_ADDR A:0x641d8830
y.create.l HWIO_MSS_CRYPTO_BAM_P_RETR_CNTXT_0_ADDR A:0x641d7834
y.create.l HWIO_MSS_CRYPTO_BAM_P_RETR_CNTXT_1_ADDR A:0x641d8834
y.create.l HWIO_MSS_CRYPTO_BAM_P_SI_CNTXT_0_ADDR A:0x641d7838
y.create.l HWIO_MSS_CRYPTO_BAM_P_SI_CNTXT_1_ADDR A:0x641d8838
y.create.l HWIO_MSS_CRYPTO_BAM_P_PSM_CNTXT_3_LSB0_ADDR A:0x641d7900
y.create.l HWIO_MSS_CRYPTO_BAM_P_PSM_CNTXT_3_LSB1_ADDR A:0x641d8900
y.create.l HWIO_MSS_CRYPTO_BAM_P_PSM_CNTXT_3_MSB0_ADDR A:0x641d7904
y.create.l HWIO_MSS_CRYPTO_BAM_P_PSM_CNTXT_3_MSB1_ADDR A:0x641d8904
y.create.l HWIO_MSS_CRYPTO_BAM_P_DESC_FIFO_ADDR_LSB0_ADDR A:0x641d7910
y.create.l HWIO_MSS_CRYPTO_BAM_P_DESC_FIFO_ADDR_LSB1_ADDR A:0x641d8910
y.create.l HWIO_MSS_CRYPTO_BAM_P_DESC_FIFO_ADDR_MSB0_ADDR A:0x641d7914
y.create.l HWIO_MSS_CRYPTO_BAM_P_DESC_FIFO_ADDR_MSB1_ADDR A:0x641d8914
y.create.l HWIO_MSS_CRYPTO_BAM_P_DATA_FIFO_ADDR_LSB0_ADDR A:0x641d7920
y.create.l HWIO_MSS_CRYPTO_BAM_P_DATA_FIFO_ADDR_LSB1_ADDR A:0x641d8920
y.create.l HWIO_MSS_CRYPTO_BAM_P_DATA_FIFO_ADDR_MSB0_ADDR A:0x641d7924
y.create.l HWIO_MSS_CRYPTO_BAM_P_DATA_FIFO_ADDR_MSB1_ADDR A:0x641d8924
y.create.l HWIO_MSS_CRYPTO_BAM_P_EVNT_DEST_ADDR_LSB0_ADDR A:0x641d7930
y.create.l HWIO_MSS_CRYPTO_BAM_P_EVNT_DEST_ADDR_LSB1_ADDR A:0x641d8930
y.create.l HWIO_MSS_CRYPTO_BAM_P_EVNT_DEST_ADDR_MSB0_ADDR A:0x641d7934
y.create.l HWIO_MSS_CRYPTO_BAM_P_EVNT_DEST_ADDR_MSB1_ADDR A:0x641d8934
y.create.l HWIO_MSS_RC_CONTROL_ADDR A:0x64200000
y.create.l HWIO_MSS_RC_CONFIG_ADDR A:0x64200004
y.create.l HWIO_MSS_RC_LPM_RTC_CONTROL_ADDR A:0x64200008
y.create.l HWIO_MSS_RC_PPSO_ASSERT_ADDR A:0x6420000c
y.create.l HWIO_MSS_RC_PPSO_DEASSERT_ADDR A:0x64200010
y.create.l HWIO_MSS_RC_GPS_ON_ADDR A:0x64200014
y.create.l HWIO_MSS_RC_TIME_TRANSFER_ADDR A:0x64200018
y.create.l HWIO_MSS_RC_GNSS_RTC_STATUS_ADDR A:0x6420001c
y.create.l HWIO_MSS_RC_BP1_COUNT_STATUS_ADDR A:0x64200020
y.create.l HWIO_MSS_RC_BP1_PHASE_STATUS_ADDR A:0x64200024
y.create.l HWIO_MSS_RC_BP2_COUNT_STATUS_ADDR A:0x64200028
y.create.l HWIO_MSS_RC_BP2_PHASE_STATUS_ADDR A:0x6420002c
y.create.l HWIO_MSS_RC_BP3_COUNT_STATUS_ADDR A:0x64200030
y.create.l HWIO_MSS_RC_BP3_PHASE_STATUS_ADDR A:0x64200034
y.create.l HWIO_MSS_RC_BP4_COUNT_STATUS_ADDR A:0x64200038
y.create.l HWIO_MSS_RC_BP4_PHASE_STATUS_ADDR A:0x6420003c
y.create.l HWIO_MSS_RC_TT_STATUS_ADDR A:0x64200040
y.create.l HWIO_MSS_RC_IRQ_STATUS_ADDR A:0x64200044
y.create.l HWIO_MSS_RC_PPSI_RTC_ADDR A:0x64200048
y.create.l HWIO_MSS_RC_NAV_TT_RTC_ADDR A:0x6420004c
y.create.l HWIO_MSS_RC_CDMA_TT_RTC_ADDR A:0x64200050
y.create.l HWIO_MSS_RC_GNSS_TT_CNT_ADDR A:0x64200054
y.create.l HWIO_MSS_RC_NAV_TEST_BUS_ADDR A:0x64200058
y.create.l HWIO_MSS_RC_B1_POLYNOMIAL_MASK_ADDR A:0x6420005c
y.create.l HWIO_MSS_AD_MODE_ADDR A:0x64200080
y.create.l HWIO_MSS_AD_RX1_CONFIG_ADDR A:0x64200084
y.create.l HWIO_MSS_AD_RX2_CONFIG_ADDR A:0x64200088
y.create.l HWIO_MSS_AD_RX1_QUANTMAP_ADDR A:0x6420008c
y.create.l HWIO_MSS_AD_RX2_QUANTMAP_ADDR A:0x64200090
y.create.l HWIO_MSS_AD_MEAS_STATUS_ADDR A:0x64200094
y.create.l HWIO_MSS_AD_RX1_MEAN_MON_ADDR A:0x64200098
y.create.l HWIO_MSS_AD_RX2_MEAN_MON_ADDR A:0x6420009c
y.create.l HWIO_MSS_AD_RX1_BLANK_MONITOR_ADDR A:0x642000a0
y.create.l HWIO_MSS_AD_RX2_BLANK_MONITOR_ADDR A:0x642000a4
y.create.l HWIO_MSS_AD_SL_INDEX_ADDR A:0x642000a8
y.create.l HWIO_MSS_AD_RX1_AMPL_MON_ADDR A:0x642000ac
y.create.l HWIO_MSS_AD_RX2_AMPL_MON_ADDR A:0x642000b0
y.create.l HWIO_MSS_AD_SPEC_ANALYZER_CMD_ADDR A:0x642000b4
y.create.l HWIO_MSS_AD_SPEC_ANALYZER_STATUS_ADDR A:0x642000b8
y.create.l HWIO_MSS_BP1_CONFIG_ADDR A:0x64200200
y.create.l HWIO_MSS_BP1_IF_FREQ_ADDR A:0x64200204
y.create.l HWIO_MSS_BP1_RS_RATE_ADDR A:0x64200208
y.create.l HWIO_MSS_BP1_OFFSET_ADDR A:0x6420020c
y.create.l HWIO_MSS_BP1_NOTCH1_ADDR A:0x64200210
y.create.l HWIO_MSS_BP1_NOTCH2_ADDR A:0x64200214
y.create.l HWIO_MSS_BP1_NOTCH3_ADDR A:0x64200218
y.create.l HWIO_MSS_BP1_NOTCH4_ADDR A:0x6420021c
y.create.l HWIO_MSS_BP1_NOTCH5_ADDR A:0x64200220
y.create.l HWIO_MSS_BP1_NOTCH6_ADDR A:0x64200224
y.create.l HWIO_MSS_BP1_EQ_COEF_REAL_ADDR A:0x64200228
y.create.l HWIO_MSS_BP1_EQ_COEF_IMAG_ADDR A:0x6420022c
y.create.l HWIO_MSS_BP1_FREQ_ADDR A:0x64200230
y.create.l HWIO_MSS_BP1_THRESH_ADDR A:0x64200234
y.create.l HWIO_MSS_BP1_PRE_NOTCH_ADDR A:0x64200238
y.create.l HWIO_MSS_BP1_RS_PHASE_ADDR A:0x6420023c
y.create.l HWIO_MSS_BP1_PRE_AMPL_MON_ADDR A:0x64200240
y.create.l HWIO_MSS_BP1_MEAN_MON_ADDR A:0x64200244
y.create.l HWIO_MSS_BP1_SCH2_AMPL_MON_ADDR A:0x64200248
y.create.l HWIO_MSS_BP1_SCH3_AMPL_MON_ADDR A:0x6420024c
y.create.l HWIO_MSS_BP2_CONFIG_ADDR A:0x64200300
y.create.l HWIO_MSS_BP2_IF_FREQ_ADDR A:0x64200304
y.create.l HWIO_MSS_BP2_RS_RATE_ADDR A:0x64200308
y.create.l HWIO_MSS_BP2_OFFSET_ADDR A:0x6420030c
y.create.l HWIO_MSS_BP2_NOTCH1_ADDR A:0x64200310
y.create.l HWIO_MSS_BP2_NOTCH2_ADDR A:0x64200314
y.create.l HWIO_MSS_BP2_NOTCH3_ADDR A:0x64200318
y.create.l HWIO_MSS_BP2_NOTCH4_ADDR A:0x6420031c
y.create.l HWIO_MSS_BP2_NOTCH5_ADDR A:0x64200320
y.create.l HWIO_MSS_BP2_NOTCH6_ADDR A:0x64200324
y.create.l HWIO_MSS_BP2_EQ_COEF_REAL_ADDR A:0x64200328
y.create.l HWIO_MSS_BP2_EQ_COEF_IMAG_ADDR A:0x6420032c
y.create.l HWIO_MSS_BP2_FREQ_ADDR A:0x64200330
y.create.l HWIO_MSS_BP2_THRESH_ADDR A:0x64200334
y.create.l HWIO_MSS_BP2_PRE_NOTCH_ADDR A:0x64200338
y.create.l HWIO_MSS_BP2_RS_PHASE_ADDR A:0x6420033c
y.create.l HWIO_MSS_BP2_PRE_AMPL_MON_ADDR A:0x64200340
y.create.l HWIO_MSS_BP2_MEAN_MON_ADDR A:0x64200344
y.create.l HWIO_MSS_BP2_SCH2_AMPL_MON_ADDR A:0x64200348
y.create.l HWIO_MSS_BP2_SCH3_AMPL_MON_ADDR A:0x6420034c
y.create.l HWIO_MSS_BP3_CONFIG_ADDR A:0x64200400
y.create.l HWIO_MSS_BP3_IF_FREQ_ADDR A:0x64200404
y.create.l HWIO_MSS_BP3_RS_RATE_ADDR A:0x64200408
y.create.l HWIO_MSS_BP3_OFFSET_ADDR A:0x6420040c
y.create.l HWIO_MSS_BP3_NOTCH1_ADDR A:0x64200410
y.create.l HWIO_MSS_BP3_NOTCH2_ADDR A:0x64200414
y.create.l HWIO_MSS_BP3_NOTCH3_ADDR A:0x64200418
y.create.l HWIO_MSS_BP3_NOTCH4_ADDR A:0x6420041c
y.create.l HWIO_MSS_BP3_NOTCH5_ADDR A:0x64200420
y.create.l HWIO_MSS_BP3_NOTCH6_ADDR A:0x64200424
y.create.l HWIO_MSS_BP3_EQ_COEF_REAL_ADDR A:0x64200428
y.create.l HWIO_MSS_BP3_EQ_COEF_IMAG_ADDR A:0x6420042c
y.create.l HWIO_MSS_BP3_RS_PHASE_ADDR A:0x64200430
y.create.l HWIO_MSS_BP3_SCH1_FREQ_ADDR A:0x64200434
y.create.l HWIO_MSS_BP3_SCH2_FREQ_ADDR A:0x64200438
y.create.l HWIO_MSS_BP3_SCH3_FREQ_ADDR A:0x6420043c
y.create.l HWIO_MSS_BP3_SCH4_FREQ_ADDR A:0x64200440
y.create.l HWIO_MSS_BP3_SCH5_FREQ_ADDR A:0x64200444
y.create.l HWIO_MSS_BP3_SCH6_FREQ_ADDR A:0x64200448
y.create.l HWIO_MSS_BP3_SCH7_FREQ_ADDR A:0x6420044c
y.create.l HWIO_MSS_BP3_SCH8_FREQ_ADDR A:0x64200450
y.create.l HWIO_MSS_BP3_SCH9_FREQ_ADDR A:0x64200454
y.create.l HWIO_MSS_BP3_SCH10_FREQ_ADDR A:0x64200458
y.create.l HWIO_MSS_BP3_SCH11_FREQ_ADDR A:0x6420045c
y.create.l HWIO_MSS_BP3_SCH12_FREQ_ADDR A:0x64200460
y.create.l HWIO_MSS_BP3_THRESH_A_ADDR A:0x64200464
y.create.l HWIO_MSS_BP3_THRESH_B_ADDR A:0x64200468
y.create.l HWIO_MSS_BP3_THRESH_C_ADDR A:0x6420046c
y.create.l HWIO_MSS_BP3_THRESH_D_ADDR A:0x64200470
y.create.l HWIO_MSS_BP3_THRESH_E_ADDR A:0x64200474
y.create.l HWIO_MSS_BP3_THRESH_F_ADDR A:0x64200478
y.create.l HWIO_MSS_BP3_PRE_AMPL_MON_ADDR A:0x6420047c
y.create.l HWIO_MSS_BP3_MEAN_MON_ADDR A:0x64200480
y.create.l HWIO_MSS_BP3_SCH1_AMPL_MON_ADDR A:0x64200484
y.create.l HWIO_MSS_BP3_SCH2_AMPL_MON_ADDR A:0x64200488
y.create.l HWIO_MSS_BP3_SCH3_AMPL_MON_ADDR A:0x6420048c
y.create.l HWIO_MSS_BP3_SCH4_AMPL_MON_ADDR A:0x64200490
y.create.l HWIO_MSS_BP3_SCH5_AMPL_MON_ADDR A:0x64200494
y.create.l HWIO_MSS_BP3_SCH6_AMPL_MON_ADDR A:0x64200498
y.create.l HWIO_MSS_BP3_SCH7_AMPL_MON_ADDR A:0x6420049c
y.create.l HWIO_MSS_BP3_SCH8_AMPL_MON_ADDR A:0x642004a0
y.create.l HWIO_MSS_BP3_SCH9_AMPL_MON_ADDR A:0x642004a4
y.create.l HWIO_MSS_BP3_SCH10_AMPL_MON_ADDR A:0x642004a8
y.create.l HWIO_MSS_BP3_SCH11_AMPL_MON_ADDR A:0x642004ac
y.create.l HWIO_MSS_BP3_SCH12_AMPL_MON_ADDR A:0x642004b0
y.create.l HWIO_MSS_BP3_SCH_MODE_ADDR A:0x642004b4
y.create.l HWIO_MSS_BP3_PRE_NOTCH_ADDR A:0x642004b8
y.create.l HWIO_MSS_BP3_NOTCH7_ADDR A:0x642004bc
y.create.l HWIO_MSS_BP3_NOTCH8_ADDR A:0x642004c0
y.create.l HWIO_MSS_BP3_NOTCH9_ADDR A:0x642004c4
y.create.l HWIO_MSS_BP3_NOTCH10_ADDR A:0x642004c8
y.create.l HWIO_MSS_BP3_NOTCH11_ADDR A:0x642004cc
y.create.l HWIO_MSS_BP3_NOTCH12_ADDR A:0x642004d0
y.create.l HWIO_MSS_BP4_CONFIG_ADDR A:0x64200500
y.create.l HWIO_MSS_BP4_IF_FREQ_ADDR A:0x64200504
y.create.l HWIO_MSS_BP4_RS_RATE_ADDR A:0x64200508
y.create.l HWIO_MSS_BP4_OFFSET_ADDR A:0x6420050c
y.create.l HWIO_MSS_BP4_NOTCH1_ADDR A:0x64200510
y.create.l HWIO_MSS_BP4_NOTCH2_ADDR A:0x64200514
y.create.l HWIO_MSS_BP4_NOTCH3_ADDR A:0x64200518
y.create.l HWIO_MSS_BP4_NOTCH4_ADDR A:0x6420051c
y.create.l HWIO_MSS_BP4_NOTCH5_ADDR A:0x64200520
y.create.l HWIO_MSS_BP4_NOTCH6_ADDR A:0x64200524
y.create.l HWIO_MSS_BP4_EQ_COEF_REAL_ADDR A:0x64200528
y.create.l HWIO_MSS_BP4_EQ_COEF_IMAG_ADDR A:0x6420052c
y.create.l HWIO_MSS_BP4_FREQ_ADDR A:0x64200530
y.create.l HWIO_MSS_BP4_THRESH_ADDR A:0x64200534
y.create.l HWIO_MSS_BP4_RS_PHASE_ADDR A:0x64200538
y.create.l HWIO_MSS_BP4_PRE_AMPL_MON_ADDR A:0x6420053c
y.create.l HWIO_MSS_BP4_MEAN_MON_ADDR A:0x64200540
y.create.l HWIO_MSS_BP4_AMPL_MON_ADDR A:0x64200544
y.create.l HWIO_MSS_BP4_PRE_NOTCH_ADDR A:0x64200548
y.create.l HWIO_MSS_LTE1_CONFIG_ADDR A:0x642002e0
y.create.l HWIO_MSS_LTE1_IF_FREQ_ADDR A:0x642002e4
y.create.l HWIO_MSS_LTE3_CONFIG_ADDR A:0x642004e0
y.create.l HWIO_MSS_LTE3_IF_FREQ_ADDR A:0x642004e4
y.create.l HWIO_MSS_TSG_CMD0_ADDR A:0x64200100
y.create.l HWIO_MSS_TSG_CH1_CONFIG_ADDR A:0x64200104
y.create.l HWIO_MSS_TSG_CH1_RS_RATE_ADDR A:0x64200108
y.create.l HWIO_MSS_TSG_CH1_INIT_COUNT_ADDR A:0x6420010c
y.create.l HWIO_MSS_TSG_CH1_FREQ_ADDR A:0x64200110
y.create.l HWIO_MSS_TSG_CH1_DATA_SEED_ADDR A:0x64200114
y.create.l HWIO_MSS_TSG_CH1_PILOT_SEED_ADDR A:0x64200118
y.create.l HWIO_MSS_TSG_CH2_CONFIG_ADDR A:0x6420011c
y.create.l HWIO_MSS_TSG_CH2_RS_RATE_ADDR A:0x64200120
y.create.l HWIO_MSS_TSG_CH2_INIT_COUNT_ADDR A:0x64200124
y.create.l HWIO_MSS_TSG_CH2_FREQ_ADDR A:0x64200128
y.create.l HWIO_MSS_TSG_CH2_DATA_SEED_ADDR A:0x6420012c
y.create.l HWIO_MSS_TSG_CH2_PILOT_SEED_ADDR A:0x64200130
y.create.l HWIO_MSS_TSG_RX1_CONFIG_ADDR A:0x64200134
y.create.l HWIO_MSS_TSG_RX1_OFFSET_ADDR A:0x64200138
y.create.l HWIO_MSS_TSG_RX2_CONFIG_ADDR A:0x6420013c
y.create.l HWIO_MSS_TSG_RX2_OFFSET_ADDR A:0x64200140
y.create.l HWIO_MSS_TSG_FIRST_CODE_ADDR A:0x64200144
y.create.l HWIO_MSS_TSG_CH1_COUNT_STATUS_ADDR A:0x64200148
y.create.l HWIO_MSS_TSG_CH2_COUNT_STATUS_ADDR A:0x6420014c
y.create.l HWIO_MSS_SMI_MODE_ADDR A:0x64200600
y.create.l HWIO_MSS_SMI_BASEADDR1_ADDR A:0x64200604
y.create.l HWIO_MSS_SMI_BASEADDR2_ADDR A:0x64200608
y.create.l HWIO_MSS_SMI_BASEADDR3A_ADDR A:0x6420060c
y.create.l HWIO_MSS_SMI_BASEADDR3B_ADDR A:0x64200610
y.create.l HWIO_MSS_SMI_BASEADDR3C_ADDR A:0x64200614
y.create.l HWIO_MSS_SMI_BASEADDR4_ADDR A:0x64200618
y.create.l HWIO_MSS_CP_START_ADDR A:0x64200700
y.create.l HWIO_MSS_CP_CONFIG1_ADDR A:0x64200704
y.create.l HWIO_MSS_CP_CONFIG2_ADDR A:0x64200708
y.create.l HWIO_MSS_CP_SAMPLE_INDEX_ADDR A:0x6420070c
y.create.l HWIO_MSS_CP_PHASE_ADDR A:0x64200710
y.create.l HWIO_MSS_CP_FREQ_ADDR A:0x64200714
y.create.l HWIO_MSS_CP_DATA_SEED_ADDR A:0x64200718
y.create.l HWIO_MSS_CP_PILOT_SEED_ADDR A:0x6420071c
y.create.l HWIO_MSS_CP_CODE_INDEX_ADDR A:0x64200720
y.create.l HWIO_MSS_CP_COEF1_ADDR A:0x64200724
y.create.l HWIO_MSS_CP_COEF2_ADDR A:0x64200728
y.create.l HWIO_MSS_CP_COEF3_ADDR A:0x6420072c
y.create.l HWIO_MSS_CP_COEF4_ADDR A:0x64200730
y.create.l HWIO_MSS_CP_COEF5_ADDR A:0x64200734
y.create.l HWIO_MSS_CP_COEF6_ADDR A:0x64200738
y.create.l HWIO_MSS_CP_STATUS_ADDR A:0x6420073c
y.create.l HWIO_MSS_CCP_BREAKPOINT_ADDR A:0x64200800
y.create.l HWIO_MSS_CCP_BREAK_STATE_ADDR A:0x64200804
y.create.l HWIO_MSS_CCP_PROG_STATUS_ADDR A:0x64200808
y.create.l HWIO_MSS_CCP_G10_STATUS_ADDR A:0x6420080c
y.create.l HWIO_MSS_CCP_G32_STATUS_ADDR A:0x64200810
y.create.l HWIO_MSS_CCP_G54_STATUS_ADDR A:0x64200814
y.create.l HWIO_MSS_CCP_G76_STATUS_ADDR A:0x64200818
y.create.l HWIO_MSS_CCP_P10_STATUS_ADDR A:0x6420081c
y.create.l HWIO_MSS_CCP_P2_STATUS_ADDR A:0x64200820
y.create.l HWIO_MSS_SM_ADDR_BEGIN_ADDR A:0x64240000
y.create.l HWIO_MSS_SM_ADDR_END_ADDR A:0x6424effc
y.create.l HWIO_MSS_GPM_ADDR_BEGIN_ADDR A:0x64204000
y.create.l HWIO_MSS_GPM_ADDR_END_ADDR A:0x642047fc
y.create.l HWIO_MSS_GDM_ADDR_BEGIN_ADDR A:0x64208000
y.create.l HWIO_MSS_GDM_ADDR_END_ADDR A:0x642087fc
y.create.l HWIO_MSS_CMA_ADDR_BEGIN_ADDR A:0x6420c000
y.create.l HWIO_MSS_CMA_ADDR_END_ADDR A:0x6420edfc
y.create.l HWIO_MSS_CMB_ADDR_BEGIN_ADDR A:0x64210000
y.create.l HWIO_MSS_CMB_ADDR_END_ADDR A:0x64212dfc
y.create.l HWIO_MSS_VM_ADDR_BEGIN_ADDR A:0x64218000
y.create.l HWIO_MSS_VM_ADDR_END_ADDR A:0x64218ffc
y.create.l HWIO_MSS_PM_ADDR_BEGIN_ADDR A:0x6421c000
y.create.l HWIO_MSS_PM_ADDR_END_ADDR A:0x6421cffc
y.create.l HWIO_MSS_CCM_START_CMD_ADDR A:0x64214000
y.create.l HWIO_MSS_CCM_WORD1_CMD_ADDR A:0x64214004
y.create.l HWIO_MSS_CCM_WORD2_CMD_ADDR A:0x64214008
y.create.l HWIO_MSS_CCM_WORD3_CMD_ADDR A:0x6421400c
y.create.l HWIO_MSS_CCM_WORD4_CMD_ADDR A:0x64214010
y.create.l HWIO_MSS_CCM_WORD5_CMD_ADDR A:0x64214014
y.create.l HWIO_MSS_CCM_WORD6_CMD_ADDR A:0x64214018
y.create.l HWIO_MSS_CCM_WORD7_CMD_ADDR A:0x6421401c
y.create.l HWIO_MSS_CCM_END_CMD_ADDR A:0x64214020
y.create.l HWIO_MSS_CCM_STOP_CMD_ADDR A:0x642147dc
y.create.l HWIO_MSS_CCM_LOAD_CMD_ADDR A:0x642147e0
y.create.l HWIO_MSS_CCM_ERROR_CLEAR_CMD_ADDR A:0x642147e4
y.create.l HWIO_MSS_CCM_TIME_MARGIN_CMD_ADDR A:0x642147e8
y.create.l HWIO_MSS_CCM_LATE_TASK_ERROR_STATUS_ADDR A:0x642147ec
y.create.l HWIO_MSS_CCM_OVERRUN_ERROR_STATUS_ADDR A:0x642147f0
y.create.l HWIO_MSS_CCM_SEQ_NUMBER_STATUS_ADDR A:0x642147f4
y.create.l HWIO_MSS_CCM_DONE_RTC_STATUS_ADDR A:0x642147f8
y.create.l HWIO_MSS_CCM_STALL_COUNT_STATUS_ADDR A:0x642147fc
y.create.l HWIO_MSS_TPM_ADDR_BEGIN_ADDR A:0x64220000
y.create.l HWIO_MSS_TPM_ADDR_END_ADDR A:0x642201fc
y.create.l HWIO_MSS_TDM_ADDR_BEGIN_ADDR A:0x64224000
y.create.l HWIO_MSS_TDM_ADDR_END_ADDR A:0x642241fc
y.create.l HWIO_MSS_GACC_CLK_CTL_ADDR A:0x64200a00
y.create.l HWIO_MSS_GACC_RTC_WAIT_ADDR A:0x64200a04
y.create.l HWIO_MSS_GACC_START_ADDR_ADDR A:0x64200a08
y.create.l HWIO_MSS_GACC_COUNT_ADDR A:0x64200a0c
y.create.l HWIO_MSS_GACC_INCR_ADDR A:0x64200a10
y.create.l HWIO_MSS_GACC_FREQ_ADDR A:0x64200a14
y.create.l HWIO_MSS_GACC_CONFIG_ADDR A:0x64200a18
y.create.l HWIO_MSS_GACC_PEAK_ADDR A:0x64200a1c
y.create.l HWIO_MSS_GACC_DONE_ADDR A:0x64200a20
y.create.l HWIO_MSS_GACC_RTC_ADDR A:0x64200a24
y.create.l HWIO_MSS_GACC_TEST_BUS_OUT_ADDR A:0x64200a28
y.create.l HWIO_MSS_GACC_SAMPLE_MEM_START_ADDR_ADDR A:0x64228000
y.create.l HWIO_MSS_GACC_SAMPLE_MEM_END_ADDR_ADDR A:0x642289fc
y.create.l HWIO_MSS_GACC_ENERGY_MEM_START_ADDR_ADDR A:0x6422c000
y.create.l HWIO_MSS_GACC_ENERGY_MEM_END_ADDR_ADDR A:0x6422c9fc
y.create.l HWIO_MSS_HI0_CH0_CMD_PTR_SD0_ADDR A:0x64200b00
y.create.l HWIO_MSS_HI0_CH0_CMD_PTR_SD1_ADDR A:0x64200f00
y.create.l HWIO_MSS_HI0_CH0_CMD_PTR_SD2_ADDR A:0x64201300
y.create.l HWIO_MSS_HI0_CH0_CMD_PTR_SD3_ADDR A:0x64201700
y.create.l HWIO_MSS_HI0_CH1_CMD_PTR_SD0_ADDR A:0x64200b04
y.create.l HWIO_MSS_HI0_CH1_CMD_PTR_SD1_ADDR A:0x64200f04
y.create.l HWIO_MSS_HI0_CH1_CMD_PTR_SD2_ADDR A:0x64201304
y.create.l HWIO_MSS_HI0_CH1_CMD_PTR_SD3_ADDR A:0x64201704
y.create.l HWIO_MSS_HI0_CH2_CMD_PTR_SD0_ADDR A:0x64200b08
y.create.l HWIO_MSS_HI0_CH2_CMD_PTR_SD1_ADDR A:0x64200f08
y.create.l HWIO_MSS_HI0_CH2_CMD_PTR_SD2_ADDR A:0x64201308
y.create.l HWIO_MSS_HI0_CH2_CMD_PTR_SD3_ADDR A:0x64201708
y.create.l HWIO_MSS_HI0_CH3_CMD_PTR_SD0_ADDR A:0x64200b0c
y.create.l HWIO_MSS_HI0_CH3_CMD_PTR_SD1_ADDR A:0x64200f0c
y.create.l HWIO_MSS_HI0_CH3_CMD_PTR_SD2_ADDR A:0x6420130c
y.create.l HWIO_MSS_HI0_CH3_CMD_PTR_SD3_ADDR A:0x6420170c
y.create.l HWIO_MSS_HI0_CH4_CMD_PTR_SD0_ADDR A:0x64200b10
y.create.l HWIO_MSS_HI0_CH4_CMD_PTR_SD1_ADDR A:0x64200f10
y.create.l HWIO_MSS_HI0_CH4_CMD_PTR_SD2_ADDR A:0x64201310
y.create.l HWIO_MSS_HI0_CH4_CMD_PTR_SD3_ADDR A:0x64201710
y.create.l HWIO_MSS_HI0_CH5_CMD_PTR_SD0_ADDR A:0x64200b14
y.create.l HWIO_MSS_HI0_CH5_CMD_PTR_SD1_ADDR A:0x64200f14
y.create.l HWIO_MSS_HI0_CH5_CMD_PTR_SD2_ADDR A:0x64201314
y.create.l HWIO_MSS_HI0_CH5_CMD_PTR_SD3_ADDR A:0x64201714
y.create.l HWIO_MSS_HI0_CH6_CMD_PTR_SD0_ADDR A:0x64200b18
y.create.l HWIO_MSS_HI0_CH6_CMD_PTR_SD1_ADDR A:0x64200f18
y.create.l HWIO_MSS_HI0_CH6_CMD_PTR_SD2_ADDR A:0x64201318
y.create.l HWIO_MSS_HI0_CH6_CMD_PTR_SD3_ADDR A:0x64201718
y.create.l HWIO_MSS_HI0_CH7_CMD_PTR_SD0_ADDR A:0x64200b1c
y.create.l HWIO_MSS_HI0_CH7_CMD_PTR_SD1_ADDR A:0x64200f1c
y.create.l HWIO_MSS_HI0_CH7_CMD_PTR_SD2_ADDR A:0x6420131c
y.create.l HWIO_MSS_HI0_CH7_CMD_PTR_SD3_ADDR A:0x6420171c
y.create.l HWIO_MSS_HI0_CH0_RSLT_SD0_ADDR A:0x64200b40
y.create.l HWIO_MSS_HI0_CH0_RSLT_SD1_ADDR A:0x64200f40
y.create.l HWIO_MSS_HI0_CH0_RSLT_SD2_ADDR A:0x64201340
y.create.l HWIO_MSS_HI0_CH0_RSLT_SD3_ADDR A:0x64201740
y.create.l HWIO_MSS_HI0_CH1_RSLT_SD0_ADDR A:0x64200b44
y.create.l HWIO_MSS_HI0_CH1_RSLT_SD1_ADDR A:0x64200f44
y.create.l HWIO_MSS_HI0_CH1_RSLT_SD2_ADDR A:0x64201344
y.create.l HWIO_MSS_HI0_CH1_RSLT_SD3_ADDR A:0x64201744
y.create.l HWIO_MSS_HI0_CH2_RSLT_SD0_ADDR A:0x64200b48
y.create.l HWIO_MSS_HI0_CH2_RSLT_SD1_ADDR A:0x64200f48
y.create.l HWIO_MSS_HI0_CH2_RSLT_SD2_ADDR A:0x64201348
y.create.l HWIO_MSS_HI0_CH2_RSLT_SD3_ADDR A:0x64201748
y.create.l HWIO_MSS_HI0_CH3_RSLT_SD0_ADDR A:0x64200b4c
y.create.l HWIO_MSS_HI0_CH3_RSLT_SD1_ADDR A:0x64200f4c
y.create.l HWIO_MSS_HI0_CH3_RSLT_SD2_ADDR A:0x6420134c
y.create.l HWIO_MSS_HI0_CH3_RSLT_SD3_ADDR A:0x6420174c
y.create.l HWIO_MSS_HI0_CH4_RSLT_SD0_ADDR A:0x64200b50
y.create.l HWIO_MSS_HI0_CH4_RSLT_SD1_ADDR A:0x64200f50
y.create.l HWIO_MSS_HI0_CH4_RSLT_SD2_ADDR A:0x64201350
y.create.l HWIO_MSS_HI0_CH4_RSLT_SD3_ADDR A:0x64201750
y.create.l HWIO_MSS_HI0_CH5_RSLT_SD0_ADDR A:0x64200b54
y.create.l HWIO_MSS_HI0_CH5_RSLT_SD1_ADDR A:0x64200f54
y.create.l HWIO_MSS_HI0_CH5_RSLT_SD2_ADDR A:0x64201354
y.create.l HWIO_MSS_HI0_CH5_RSLT_SD3_ADDR A:0x64201754
y.create.l HWIO_MSS_HI0_CH6_RSLT_SD0_ADDR A:0x64200b58
y.create.l HWIO_MSS_HI0_CH6_RSLT_SD1_ADDR A:0x64200f58
y.create.l HWIO_MSS_HI0_CH6_RSLT_SD2_ADDR A:0x64201358
y.create.l HWIO_MSS_HI0_CH6_RSLT_SD3_ADDR A:0x64201758
y.create.l HWIO_MSS_HI0_CH7_RSLT_SD0_ADDR A:0x64200b5c
y.create.l HWIO_MSS_HI0_CH7_RSLT_SD1_ADDR A:0x64200f5c
y.create.l HWIO_MSS_HI0_CH7_RSLT_SD2_ADDR A:0x6420135c
y.create.l HWIO_MSS_HI0_CH7_RSLT_SD3_ADDR A:0x6420175c
y.create.l HWIO_MSS_HI0_CH0_FLUSH_STATE0_SD0_ADDR A:0x64200b80
y.create.l HWIO_MSS_HI0_CH0_FLUSH_STATE0_SD1_ADDR A:0x64200f80
y.create.l HWIO_MSS_HI0_CH0_FLUSH_STATE0_SD2_ADDR A:0x64201380
y.create.l HWIO_MSS_HI0_CH0_FLUSH_STATE0_SD3_ADDR A:0x64201780
y.create.l HWIO_MSS_HI0_CH1_FLUSH_STATE0_SD0_ADDR A:0x64200b84
y.create.l HWIO_MSS_HI0_CH1_FLUSH_STATE0_SD1_ADDR A:0x64200f84
y.create.l HWIO_MSS_HI0_CH1_FLUSH_STATE0_SD2_ADDR A:0x64201384
y.create.l HWIO_MSS_HI0_CH1_FLUSH_STATE0_SD3_ADDR A:0x64201784
y.create.l HWIO_MSS_HI0_CH2_FLUSH_STATE0_SD0_ADDR A:0x64200b88
y.create.l HWIO_MSS_HI0_CH2_FLUSH_STATE0_SD1_ADDR A:0x64200f88
y.create.l HWIO_MSS_HI0_CH2_FLUSH_STATE0_SD2_ADDR A:0x64201388
y.create.l HWIO_MSS_HI0_CH2_FLUSH_STATE0_SD3_ADDR A:0x64201788
y.create.l HWIO_MSS_HI0_CH3_FLUSH_STATE0_SD0_ADDR A:0x64200b8c
y.create.l HWIO_MSS_HI0_CH3_FLUSH_STATE0_SD1_ADDR A:0x64200f8c
y.create.l HWIO_MSS_HI0_CH3_FLUSH_STATE0_SD2_ADDR A:0x6420138c
y.create.l HWIO_MSS_HI0_CH3_FLUSH_STATE0_SD3_ADDR A:0x6420178c
y.create.l HWIO_MSS_HI0_CH4_FLUSH_STATE0_SD0_ADDR A:0x64200b90
y.create.l HWIO_MSS_HI0_CH4_FLUSH_STATE0_SD1_ADDR A:0x64200f90
y.create.l HWIO_MSS_HI0_CH4_FLUSH_STATE0_SD2_ADDR A:0x64201390
y.create.l HWIO_MSS_HI0_CH4_FLUSH_STATE0_SD3_ADDR A:0x64201790
y.create.l HWIO_MSS_HI0_CH5_FLUSH_STATE0_SD0_ADDR A:0x64200b94
y.create.l HWIO_MSS_HI0_CH5_FLUSH_STATE0_SD1_ADDR A:0x64200f94
y.create.l HWIO_MSS_HI0_CH5_FLUSH_STATE0_SD2_ADDR A:0x64201394
y.create.l HWIO_MSS_HI0_CH5_FLUSH_STATE0_SD3_ADDR A:0x64201794
y.create.l HWIO_MSS_HI0_CH6_FLUSH_STATE0_SD0_ADDR A:0x64200b98
y.create.l HWIO_MSS_HI0_CH6_FLUSH_STATE0_SD1_ADDR A:0x64200f98
y.create.l HWIO_MSS_HI0_CH6_FLUSH_STATE0_SD2_ADDR A:0x64201398
y.create.l HWIO_MSS_HI0_CH6_FLUSH_STATE0_SD3_ADDR A:0x64201798
y.create.l HWIO_MSS_HI0_CH7_FLUSH_STATE0_SD0_ADDR A:0x64200b9c
y.create.l HWIO_MSS_HI0_CH7_FLUSH_STATE0_SD1_ADDR A:0x64200f9c
y.create.l HWIO_MSS_HI0_CH7_FLUSH_STATE0_SD2_ADDR A:0x6420139c
y.create.l HWIO_MSS_HI0_CH7_FLUSH_STATE0_SD3_ADDR A:0x6420179c
y.create.l HWIO_MSS_HI0_CH0_FLUSH_STATE1_SD0_ADDR A:0x64200bc0
y.create.l HWIO_MSS_HI0_CH0_FLUSH_STATE1_SD1_ADDR A:0x64200fc0
y.create.l HWIO_MSS_HI0_CH0_FLUSH_STATE1_SD2_ADDR A:0x642013c0
y.create.l HWIO_MSS_HI0_CH0_FLUSH_STATE1_SD3_ADDR A:0x642017c0
y.create.l HWIO_MSS_HI0_CH1_FLUSH_STATE1_SD0_ADDR A:0x64200bc4
y.create.l HWIO_MSS_HI0_CH1_FLUSH_STATE1_SD1_ADDR A:0x64200fc4
y.create.l HWIO_MSS_HI0_CH1_FLUSH_STATE1_SD2_ADDR A:0x642013c4
y.create.l HWIO_MSS_HI0_CH1_FLUSH_STATE1_SD3_ADDR A:0x642017c4
y.create.l HWIO_MSS_HI0_CH2_FLUSH_STATE1_SD0_ADDR A:0x64200bc8
y.create.l HWIO_MSS_HI0_CH2_FLUSH_STATE1_SD1_ADDR A:0x64200fc8
y.create.l HWIO_MSS_HI0_CH2_FLUSH_STATE1_SD2_ADDR A:0x642013c8
y.create.l HWIO_MSS_HI0_CH2_FLUSH_STATE1_SD3_ADDR A:0x642017c8
y.create.l HWIO_MSS_HI0_CH3_FLUSH_STATE1_SD0_ADDR A:0x64200bcc
y.create.l HWIO_MSS_HI0_CH3_FLUSH_STATE1_SD1_ADDR A:0x64200fcc
y.create.l HWIO_MSS_HI0_CH3_FLUSH_STATE1_SD2_ADDR A:0x642013cc
y.create.l HWIO_MSS_HI0_CH3_FLUSH_STATE1_SD3_ADDR A:0x642017cc
y.create.l HWIO_MSS_HI0_CH4_FLUSH_STATE1_SD0_ADDR A:0x64200bd0
y.create.l HWIO_MSS_HI0_CH4_FLUSH_STATE1_SD1_ADDR A:0x64200fd0
y.create.l HWIO_MSS_HI0_CH4_FLUSH_STATE1_SD2_ADDR A:0x642013d0
y.create.l HWIO_MSS_HI0_CH4_FLUSH_STATE1_SD3_ADDR A:0x642017d0
y.create.l HWIO_MSS_HI0_CH5_FLUSH_STATE1_SD0_ADDR A:0x64200bd4
y.create.l HWIO_MSS_HI0_CH5_FLUSH_STATE1_SD1_ADDR A:0x64200fd4
y.create.l HWIO_MSS_HI0_CH5_FLUSH_STATE1_SD2_ADDR A:0x642013d4
y.create.l HWIO_MSS_HI0_CH5_FLUSH_STATE1_SD3_ADDR A:0x642017d4
y.create.l HWIO_MSS_HI0_CH6_FLUSH_STATE1_SD0_ADDR A:0x64200bd8
y.create.l HWIO_MSS_HI0_CH6_FLUSH_STATE1_SD1_ADDR A:0x64200fd8
y.create.l HWIO_MSS_HI0_CH6_FLUSH_STATE1_SD2_ADDR A:0x642013d8
y.create.l HWIO_MSS_HI0_CH6_FLUSH_STATE1_SD3_ADDR A:0x642017d8
y.create.l HWIO_MSS_HI0_CH7_FLUSH_STATE1_SD0_ADDR A:0x64200bdc
y.create.l HWIO_MSS_HI0_CH7_FLUSH_STATE1_SD1_ADDR A:0x64200fdc
y.create.l HWIO_MSS_HI0_CH7_FLUSH_STATE1_SD2_ADDR A:0x642013dc
y.create.l HWIO_MSS_HI0_CH7_FLUSH_STATE1_SD3_ADDR A:0x642017dc
y.create.l HWIO_MSS_HI0_CH0_FLUSH_STATE3_SD0_ADDR A:0x64200c40
y.create.l HWIO_MSS_HI0_CH0_FLUSH_STATE3_SD1_ADDR A:0x64201040
y.create.l HWIO_MSS_HI0_CH0_FLUSH_STATE3_SD2_ADDR A:0x64201440
y.create.l HWIO_MSS_HI0_CH0_FLUSH_STATE3_SD3_ADDR A:0x64201840
y.create.l HWIO_MSS_HI0_CH1_FLUSH_STATE3_SD0_ADDR A:0x64200c44
y.create.l HWIO_MSS_HI0_CH1_FLUSH_STATE3_SD1_ADDR A:0x64201044
y.create.l HWIO_MSS_HI0_CH1_FLUSH_STATE3_SD2_ADDR A:0x64201444
y.create.l HWIO_MSS_HI0_CH1_FLUSH_STATE3_SD3_ADDR A:0x64201844
y.create.l HWIO_MSS_HI0_CH2_FLUSH_STATE3_SD0_ADDR A:0x64200c48
y.create.l HWIO_MSS_HI0_CH2_FLUSH_STATE3_SD1_ADDR A:0x64201048
y.create.l HWIO_MSS_HI0_CH2_FLUSH_STATE3_SD2_ADDR A:0x64201448
y.create.l HWIO_MSS_HI0_CH2_FLUSH_STATE3_SD3_ADDR A:0x64201848
y.create.l HWIO_MSS_HI0_CH3_FLUSH_STATE3_SD0_ADDR A:0x64200c4c
y.create.l HWIO_MSS_HI0_CH3_FLUSH_STATE3_SD1_ADDR A:0x6420104c
y.create.l HWIO_MSS_HI0_CH3_FLUSH_STATE3_SD2_ADDR A:0x6420144c
y.create.l HWIO_MSS_HI0_CH3_FLUSH_STATE3_SD3_ADDR A:0x6420184c
y.create.l HWIO_MSS_HI0_CH4_FLUSH_STATE3_SD0_ADDR A:0x64200c50
y.create.l HWIO_MSS_HI0_CH4_FLUSH_STATE3_SD1_ADDR A:0x64201050
y.create.l HWIO_MSS_HI0_CH4_FLUSH_STATE3_SD2_ADDR A:0x64201450
y.create.l HWIO_MSS_HI0_CH4_FLUSH_STATE3_SD3_ADDR A:0x64201850
y.create.l HWIO_MSS_HI0_CH5_FLUSH_STATE3_SD0_ADDR A:0x64200c54
y.create.l HWIO_MSS_HI0_CH5_FLUSH_STATE3_SD1_ADDR A:0x64201054
y.create.l HWIO_MSS_HI0_CH5_FLUSH_STATE3_SD2_ADDR A:0x64201454
y.create.l HWIO_MSS_HI0_CH5_FLUSH_STATE3_SD3_ADDR A:0x64201854
y.create.l HWIO_MSS_HI0_CH6_FLUSH_STATE3_SD0_ADDR A:0x64200c58
y.create.l HWIO_MSS_HI0_CH6_FLUSH_STATE3_SD1_ADDR A:0x64201058
y.create.l HWIO_MSS_HI0_CH6_FLUSH_STATE3_SD2_ADDR A:0x64201458
y.create.l HWIO_MSS_HI0_CH6_FLUSH_STATE3_SD3_ADDR A:0x64201858
y.create.l HWIO_MSS_HI0_CH7_FLUSH_STATE3_SD0_ADDR A:0x64200c5c
y.create.l HWIO_MSS_HI0_CH7_FLUSH_STATE3_SD1_ADDR A:0x6420105c
y.create.l HWIO_MSS_HI0_CH7_FLUSH_STATE3_SD2_ADDR A:0x6420145c
y.create.l HWIO_MSS_HI0_CH7_FLUSH_STATE3_SD3_ADDR A:0x6420185c
y.create.l HWIO_MSS_HI0_CH0_FLUSH_STATE4_SD0_ADDR A:0x64200c80
y.create.l HWIO_MSS_HI0_CH0_FLUSH_STATE4_SD1_ADDR A:0x64201080
y.create.l HWIO_MSS_HI0_CH0_FLUSH_STATE4_SD2_ADDR A:0x64201480
y.create.l HWIO_MSS_HI0_CH0_FLUSH_STATE4_SD3_ADDR A:0x64201880
y.create.l HWIO_MSS_HI0_CH1_FLUSH_STATE4_SD0_ADDR A:0x64200c84
y.create.l HWIO_MSS_HI0_CH1_FLUSH_STATE4_SD1_ADDR A:0x64201084
y.create.l HWIO_MSS_HI0_CH1_FLUSH_STATE4_SD2_ADDR A:0x64201484
y.create.l HWIO_MSS_HI0_CH1_FLUSH_STATE4_SD3_ADDR A:0x64201884
y.create.l HWIO_MSS_HI0_CH2_FLUSH_STATE4_SD0_ADDR A:0x64200c88
y.create.l HWIO_MSS_HI0_CH2_FLUSH_STATE4_SD1_ADDR A:0x64201088
y.create.l HWIO_MSS_HI0_CH2_FLUSH_STATE4_SD2_ADDR A:0x64201488
y.create.l HWIO_MSS_HI0_CH2_FLUSH_STATE4_SD3_ADDR A:0x64201888
y.create.l HWIO_MSS_HI0_CH3_FLUSH_STATE4_SD0_ADDR A:0x64200c8c
y.create.l HWIO_MSS_HI0_CH3_FLUSH_STATE4_SD1_ADDR A:0x6420108c
y.create.l HWIO_MSS_HI0_CH3_FLUSH_STATE4_SD2_ADDR A:0x6420148c
y.create.l HWIO_MSS_HI0_CH3_FLUSH_STATE4_SD3_ADDR A:0x6420188c
y.create.l HWIO_MSS_HI0_CH4_FLUSH_STATE4_SD0_ADDR A:0x64200c90
y.create.l HWIO_MSS_HI0_CH4_FLUSH_STATE4_SD1_ADDR A:0x64201090
y.create.l HWIO_MSS_HI0_CH4_FLUSH_STATE4_SD2_ADDR A:0x64201490
y.create.l HWIO_MSS_HI0_CH4_FLUSH_STATE4_SD3_ADDR A:0x64201890
y.create.l HWIO_MSS_HI0_CH5_FLUSH_STATE4_SD0_ADDR A:0x64200c94
y.create.l HWIO_MSS_HI0_CH5_FLUSH_STATE4_SD1_ADDR A:0x64201094
y.create.l HWIO_MSS_HI0_CH5_FLUSH_STATE4_SD2_ADDR A:0x64201494
y.create.l HWIO_MSS_HI0_CH5_FLUSH_STATE4_SD3_ADDR A:0x64201894
y.create.l HWIO_MSS_HI0_CH6_FLUSH_STATE4_SD0_ADDR A:0x64200c98
y.create.l HWIO_MSS_HI0_CH6_FLUSH_STATE4_SD1_ADDR A:0x64201098
y.create.l HWIO_MSS_HI0_CH6_FLUSH_STATE4_SD2_ADDR A:0x64201498
y.create.l HWIO_MSS_HI0_CH6_FLUSH_STATE4_SD3_ADDR A:0x64201898
y.create.l HWIO_MSS_HI0_CH7_FLUSH_STATE4_SD0_ADDR A:0x64200c9c
y.create.l HWIO_MSS_HI0_CH7_FLUSH_STATE4_SD1_ADDR A:0x6420109c
y.create.l HWIO_MSS_HI0_CH7_FLUSH_STATE4_SD2_ADDR A:0x6420149c
y.create.l HWIO_MSS_HI0_CH7_FLUSH_STATE4_SD3_ADDR A:0x6420189c
y.create.l HWIO_MSS_HI0_CH0_FLUSH_STATE5_SD0_ADDR A:0x64200cc0
y.create.l HWIO_MSS_HI0_CH0_FLUSH_STATE5_SD1_ADDR A:0x642010c0
y.create.l HWIO_MSS_HI0_CH0_FLUSH_STATE5_SD2_ADDR A:0x642014c0
y.create.l HWIO_MSS_HI0_CH0_FLUSH_STATE5_SD3_ADDR A:0x642018c0
y.create.l HWIO_MSS_HI0_CH1_FLUSH_STATE5_SD0_ADDR A:0x64200cc4
y.create.l HWIO_MSS_HI0_CH1_FLUSH_STATE5_SD1_ADDR A:0x642010c4
y.create.l HWIO_MSS_HI0_CH1_FLUSH_STATE5_SD2_ADDR A:0x642014c4
y.create.l HWIO_MSS_HI0_CH1_FLUSH_STATE5_SD3_ADDR A:0x642018c4
y.create.l HWIO_MSS_HI0_CH2_FLUSH_STATE5_SD0_ADDR A:0x64200cc8
y.create.l HWIO_MSS_HI0_CH2_FLUSH_STATE5_SD1_ADDR A:0x642010c8
y.create.l HWIO_MSS_HI0_CH2_FLUSH_STATE5_SD2_ADDR A:0x642014c8
y.create.l HWIO_MSS_HI0_CH2_FLUSH_STATE5_SD3_ADDR A:0x642018c8
y.create.l HWIO_MSS_HI0_CH3_FLUSH_STATE5_SD0_ADDR A:0x64200ccc
y.create.l HWIO_MSS_HI0_CH3_FLUSH_STATE5_SD1_ADDR A:0x642010cc
y.create.l HWIO_MSS_HI0_CH3_FLUSH_STATE5_SD2_ADDR A:0x642014cc
y.create.l HWIO_MSS_HI0_CH3_FLUSH_STATE5_SD3_ADDR A:0x642018cc
y.create.l HWIO_MSS_HI0_CH4_FLUSH_STATE5_SD0_ADDR A:0x64200cd0
y.create.l HWIO_MSS_HI0_CH4_FLUSH_STATE5_SD1_ADDR A:0x642010d0
y.create.l HWIO_MSS_HI0_CH4_FLUSH_STATE5_SD2_ADDR A:0x642014d0
y.create.l HWIO_MSS_HI0_CH4_FLUSH_STATE5_SD3_ADDR A:0x642018d0
y.create.l HWIO_MSS_HI0_CH5_FLUSH_STATE5_SD0_ADDR A:0x64200cd4
y.create.l HWIO_MSS_HI0_CH5_FLUSH_STATE5_SD1_ADDR A:0x642010d4
y.create.l HWIO_MSS_HI0_CH5_FLUSH_STATE5_SD2_ADDR A:0x642014d4
y.create.l HWIO_MSS_HI0_CH5_FLUSH_STATE5_SD3_ADDR A:0x642018d4
y.create.l HWIO_MSS_HI0_CH6_FLUSH_STATE5_SD0_ADDR A:0x64200cd8
y.create.l HWIO_MSS_HI0_CH6_FLUSH_STATE5_SD1_ADDR A:0x642010d8
y.create.l HWIO_MSS_HI0_CH6_FLUSH_STATE5_SD2_ADDR A:0x642014d8
y.create.l HWIO_MSS_HI0_CH6_FLUSH_STATE5_SD3_ADDR A:0x642018d8
y.create.l HWIO_MSS_HI0_CH7_FLUSH_STATE5_SD0_ADDR A:0x64200cdc
y.create.l HWIO_MSS_HI0_CH7_FLUSH_STATE5_SD1_ADDR A:0x642010dc
y.create.l HWIO_MSS_HI0_CH7_FLUSH_STATE5_SD2_ADDR A:0x642014dc
y.create.l HWIO_MSS_HI0_CH7_FLUSH_STATE5_SD3_ADDR A:0x642018dc
y.create.l HWIO_MSS_HI0_SEC_DOMAIN_IRQ_STATUS_SD0_ADDR A:0x64200e80
y.create.l HWIO_MSS_HI0_SEC_DOMAIN_IRQ_STATUS_SD1_ADDR A:0x64201280
y.create.l HWIO_MSS_HI0_SEC_DOMAIN_IRQ_STATUS_SD2_ADDR A:0x64201680
y.create.l HWIO_MSS_HI0_SEC_DOMAIN_IRQ_STATUS_SD3_ADDR A:0x64201a80
y.create.l HWIO_MSS_HI0_CH0_RSLT_CONF_SD0_ADDR A:0x64200e00
y.create.l HWIO_MSS_HI0_CH0_RSLT_CONF_SD1_ADDR A:0x64201200
y.create.l HWIO_MSS_HI0_CH0_RSLT_CONF_SD2_ADDR A:0x64201600
y.create.l HWIO_MSS_HI0_CH0_RSLT_CONF_SD3_ADDR A:0x64201a00
y.create.l HWIO_MSS_HI0_CH1_RSLT_CONF_SD0_ADDR A:0x64200e04
y.create.l HWIO_MSS_HI0_CH1_RSLT_CONF_SD1_ADDR A:0x64201204
y.create.l HWIO_MSS_HI0_CH1_RSLT_CONF_SD2_ADDR A:0x64201604
y.create.l HWIO_MSS_HI0_CH1_RSLT_CONF_SD3_ADDR A:0x64201a04
y.create.l HWIO_MSS_HI0_CH2_RSLT_CONF_SD0_ADDR A:0x64200e08
y.create.l HWIO_MSS_HI0_CH2_RSLT_CONF_SD1_ADDR A:0x64201208
y.create.l HWIO_MSS_HI0_CH2_RSLT_CONF_SD2_ADDR A:0x64201608
y.create.l HWIO_MSS_HI0_CH2_RSLT_CONF_SD3_ADDR A:0x64201a08
y.create.l HWIO_MSS_HI0_CH3_RSLT_CONF_SD0_ADDR A:0x64200e0c
y.create.l HWIO_MSS_HI0_CH3_RSLT_CONF_SD1_ADDR A:0x6420120c
y.create.l HWIO_MSS_HI0_CH3_RSLT_CONF_SD2_ADDR A:0x6420160c
y.create.l HWIO_MSS_HI0_CH3_RSLT_CONF_SD3_ADDR A:0x64201a0c
y.create.l HWIO_MSS_HI0_CH4_RSLT_CONF_SD0_ADDR A:0x64200e10
y.create.l HWIO_MSS_HI0_CH4_RSLT_CONF_SD1_ADDR A:0x64201210
y.create.l HWIO_MSS_HI0_CH4_RSLT_CONF_SD2_ADDR A:0x64201610
y.create.l HWIO_MSS_HI0_CH4_RSLT_CONF_SD3_ADDR A:0x64201a10
y.create.l HWIO_MSS_HI0_CH5_RSLT_CONF_SD0_ADDR A:0x64200e14
y.create.l HWIO_MSS_HI0_CH5_RSLT_CONF_SD1_ADDR A:0x64201214
y.create.l HWIO_MSS_HI0_CH5_RSLT_CONF_SD2_ADDR A:0x64201614
y.create.l HWIO_MSS_HI0_CH5_RSLT_CONF_SD3_ADDR A:0x64201a14
y.create.l HWIO_MSS_HI0_CH6_RSLT_CONF_SD0_ADDR A:0x64200e18
y.create.l HWIO_MSS_HI0_CH6_RSLT_CONF_SD1_ADDR A:0x64201218
y.create.l HWIO_MSS_HI0_CH6_RSLT_CONF_SD2_ADDR A:0x64201618
y.create.l HWIO_MSS_HI0_CH6_RSLT_CONF_SD3_ADDR A:0x64201a18
y.create.l HWIO_MSS_HI0_CH7_RSLT_CONF_SD0_ADDR A:0x64200e1c
y.create.l HWIO_MSS_HI0_CH7_RSLT_CONF_SD1_ADDR A:0x6420121c
y.create.l HWIO_MSS_HI0_CH7_RSLT_CONF_SD2_ADDR A:0x6420161c
y.create.l HWIO_MSS_HI0_CH7_RSLT_CONF_SD3_ADDR A:0x64201a1c
y.create.l HWIO_MSS_HI0_CH0_STATUS_SD0_ADDR A:0x64200d00
y.create.l HWIO_MSS_HI0_CH0_STATUS_SD1_ADDR A:0x64201100
y.create.l HWIO_MSS_HI0_CH0_STATUS_SD2_ADDR A:0x64201500
y.create.l HWIO_MSS_HI0_CH0_STATUS_SD3_ADDR A:0x64201900
y.create.l HWIO_MSS_HI0_CH1_STATUS_SD0_ADDR A:0x64200d04
y.create.l HWIO_MSS_HI0_CH1_STATUS_SD1_ADDR A:0x64201104
y.create.l HWIO_MSS_HI0_CH1_STATUS_SD2_ADDR A:0x64201504
y.create.l HWIO_MSS_HI0_CH1_STATUS_SD3_ADDR A:0x64201904
y.create.l HWIO_MSS_HI0_CH2_STATUS_SD0_ADDR A:0x64200d08
y.create.l HWIO_MSS_HI0_CH2_STATUS_SD1_ADDR A:0x64201108
y.create.l HWIO_MSS_HI0_CH2_STATUS_SD2_ADDR A:0x64201508
y.create.l HWIO_MSS_HI0_CH2_STATUS_SD3_ADDR A:0x64201908
y.create.l HWIO_MSS_HI0_CH3_STATUS_SD0_ADDR A:0x64200d0c
y.create.l HWIO_MSS_HI0_CH3_STATUS_SD1_ADDR A:0x6420110c
y.create.l HWIO_MSS_HI0_CH3_STATUS_SD2_ADDR A:0x6420150c
y.create.l HWIO_MSS_HI0_CH3_STATUS_SD3_ADDR A:0x6420190c
y.create.l HWIO_MSS_HI0_CH4_STATUS_SD0_ADDR A:0x64200d10
y.create.l HWIO_MSS_HI0_CH4_STATUS_SD1_ADDR A:0x64201110
y.create.l HWIO_MSS_HI0_CH4_STATUS_SD2_ADDR A:0x64201510
y.create.l HWIO_MSS_HI0_CH4_STATUS_SD3_ADDR A:0x64201910
y.create.l HWIO_MSS_HI0_CH5_STATUS_SD0_ADDR A:0x64200d14
y.create.l HWIO_MSS_HI0_CH5_STATUS_SD1_ADDR A:0x64201114
y.create.l HWIO_MSS_HI0_CH5_STATUS_SD2_ADDR A:0x64201514
y.create.l HWIO_MSS_HI0_CH5_STATUS_SD3_ADDR A:0x64201914
y.create.l HWIO_MSS_HI0_CH6_STATUS_SD0_ADDR A:0x64200d18
y.create.l HWIO_MSS_HI0_CH6_STATUS_SD1_ADDR A:0x64201118
y.create.l HWIO_MSS_HI0_CH6_STATUS_SD2_ADDR A:0x64201518
y.create.l HWIO_MSS_HI0_CH6_STATUS_SD3_ADDR A:0x64201918
y.create.l HWIO_MSS_HI0_CH7_STATUS_SD0_ADDR A:0x64200d1c
y.create.l HWIO_MSS_HI0_CH7_STATUS_SD1_ADDR A:0x6420111c
y.create.l HWIO_MSS_HI0_CH7_STATUS_SD2_ADDR A:0x6420151c
y.create.l HWIO_MSS_HI0_CH7_STATUS_SD3_ADDR A:0x6420191c
y.create.l HWIO_MSS_HI0_CH0_CONF_ADDR A:0x64200d40
y.create.l HWIO_MSS_HI0_CH1_CONF_ADDR A:0x64200d44
y.create.l HWIO_MSS_HI0_CH2_CONF_ADDR A:0x64200d48
y.create.l HWIO_MSS_HI0_CH3_CONF_ADDR A:0x64200d4c
y.create.l HWIO_MSS_HI0_CH4_CONF_ADDR A:0x64200d50
y.create.l HWIO_MSS_HI0_CH5_CONF_ADDR A:0x64200d54
y.create.l HWIO_MSS_HI0_CH6_CONF_ADDR A:0x64200d58
y.create.l HWIO_MSS_HI0_CH7_CONF_ADDR A:0x64200d5c
y.create.l HWIO_MSS_HI0_CH0_DBG_0_ADDR A:0x64200d80
y.create.l HWIO_MSS_HI0_CH1_DBG_0_ADDR A:0x64200d84
y.create.l HWIO_MSS_HI0_CH2_DBG_0_ADDR A:0x64200d88
y.create.l HWIO_MSS_HI0_CH3_DBG_0_ADDR A:0x64200d8c
y.create.l HWIO_MSS_HI0_CH4_DBG_0_ADDR A:0x64200d90
y.create.l HWIO_MSS_HI0_CH5_DBG_0_ADDR A:0x64200d94
y.create.l HWIO_MSS_HI0_CH6_DBG_0_ADDR A:0x64200d98
y.create.l HWIO_MSS_HI0_CH7_DBG_0_ADDR A:0x64200d9c
y.create.l HWIO_MSS_HI0_CH0_DBG_1_ADDR A:0x64200dc0
y.create.l HWIO_MSS_HI0_CH1_DBG_1_ADDR A:0x64200dc4
y.create.l HWIO_MSS_HI0_CH2_DBG_1_ADDR A:0x64200dc8
y.create.l HWIO_MSS_HI0_CH3_DBG_1_ADDR A:0x64200dcc
y.create.l HWIO_MSS_HI0_CH4_DBG_1_ADDR A:0x64200dd0
y.create.l HWIO_MSS_HI0_CH5_DBG_1_ADDR A:0x64200dd4
y.create.l HWIO_MSS_HI0_CH6_DBG_1_ADDR A:0x64200dd8
y.create.l HWIO_MSS_HI0_CH7_DBG_1_ADDR A:0x64200ddc
y.create.l HWIO_MSS_HI0_CI0_CONF_ADDR A:0x64200e90
y.create.l HWIO_MSS_HI0_CI1_CONF_ADDR A:0x64200e94
y.create.l HWIO_MSS_HI0_CI2_CONF_ADDR A:0x64200e98
y.create.l HWIO_MSS_HI0_CI3_CONF_ADDR A:0x64200e9c
y.create.l HWIO_MSS_HI0_CI4_CONF_ADDR A:0x64200ea0
y.create.l HWIO_MSS_HI0_CI5_CONF_ADDR A:0x64200ea4
y.create.l HWIO_MSS_HI0_CI6_CONF_ADDR A:0x64200ea8
y.create.l HWIO_MSS_HI0_CI7_CONF_ADDR A:0x64200eac
y.create.l HWIO_MSS_HI0_CI0_DBG_ERR_ADDR A:0x64200eb0
y.create.l HWIO_MSS_HI0_CI1_DBG_ERR_ADDR A:0x64200eb4
y.create.l HWIO_MSS_HI0_CI2_DBG_ERR_ADDR A:0x64200eb8
y.create.l HWIO_MSS_HI0_CI3_DBG_ERR_ADDR A:0x64200ebc
y.create.l HWIO_MSS_HI0_CI4_DBG_ERR_ADDR A:0x64200ec0
y.create.l HWIO_MSS_HI0_CI5_DBG_ERR_ADDR A:0x64200ec4
y.create.l HWIO_MSS_HI0_CI6_DBG_ERR_ADDR A:0x64200ec8
y.create.l HWIO_MSS_HI0_CI7_DBG_ERR_ADDR A:0x64200ecc
y.create.l HWIO_MSS_HI0_CRCI_DBG_ADDR A:0x64200ed0
y.create.l HWIO_MSS_HI0_CRCI_STATUS_ADDR A:0x64200ed4
y.create.l HWIO_MSS_HI0_GP_CTL_ADDR A:0x64200ed8
y.create.l HWIO_MSS_HI0_GP_STATUS_ADDR A:0x64200edc
y.create.l HWIO_MSS_HI0_GLBL_DBG_CMD_ENG_ADDR A:0x64200ee0
y.create.l HWIO_MSS_HI0_GLBL_DBG_REQ_ENG_ADDR A:0x64200ee4
y.create.l HWIO_MSS_HI0_GLBL_DBG_XFR_ENG_ADDR A:0x64200ee8
y.create.l HWIO_MSS_HI0_GLBL_DBG_CHAN_BLK_ADDR A:0x64200eec
y.create.l HWIO_MSS_HI0_GLBL_DBG_CHAN_BLK_CLR_ADDR A:0x64200ef0
y.create.l HWIO_MSS_HI0_GLBL_DBG_TEST_SEL_ADDR A:0x64200ef4
y.create.l HWIO_MSS_NAV_CLK_ENABLE_ADDR A:0x642f8000
y.create.l HWIO_MSS_NAV_CLK_RESET_ADDR A:0x642f8004
y.create.l HWIO_MSS_NAV_CLK_CTL_ADDR A:0x642f8008
y.create.l HWIO_MSS_NAV_CLK_FRAC31_M_ADDR A:0x642f800c
y.create.l HWIO_MSS_NAV_CLK_FRAC31_NOT_2D_ADDR A:0x642f8010
y.create.l HWIO_MSS_NAV_CLK_FRAC31_NOT_N_MINUS_M_ADDR A:0x642f8014
y.create.l HWIO_MSS_NAV_CLK_FRAC31_UPDATE_ADDR A:0x642f8018
y.create.l HWIO_MSS_NAV_CLK_GDS_ADDR A:0x642f801c
y.create.l HWIO_MSS_NAV_CLK_IPCAT_ADDR A:0x642f8020
y.create.l HWIO_MSS_NAV_CLK_AXI_BRIDGE_STATUS_ADDR A:0x642f8024
y.create.l HWIO_MSS_GNSS_ADC_CMD0_ADDR A:0x642f0000
y.create.l HWIO_MSS_GNSS_ADC_CMD1_ADDR A:0x642f0004
y.create.l HWIO_MSS_GNSS_ADC_CMD2_ADDR A:0x642f0008
y.create.l HWIO_MSS_GNSS_ADC_CMD3_ADDR A:0x642f000c
y.create.l HWIO_MSS_GNSS_ADC_IDDQ_ADDR A:0x642f0010
y.create.l HWIO_MSS_NAV_PLL4_PLLMODE_ADDR A:0x642f8800
y.create.l HWIO_MSS_NAV_PLL4_L_VAL_ADDR A:0x642f8804
y.create.l HWIO_MSS_NAV_PLL4_ALPHA_VAL_L_ADDR A:0x642f8808
y.create.l HWIO_MSS_NAV_PLL4_ALPHA_VAL_H_ADDR A:0x642f880c
y.create.l HWIO_MSS_NAV_PLL4_USER_CTL_ADDR A:0x642f8810
y.create.l HWIO_MSS_NAV_PLL4_USER_CTL_H_ADDR A:0x642f8814
y.create.l HWIO_MSS_NAV_PLL4_CONFIG_CTL_ADDR A:0x642f8818
y.create.l HWIO_MSS_NAV_PLL4_TEST_CTL_ADDR A:0x642f881c
y.create.l HWIO_MSS_NAV_PLL4_STATUS_ADDR A:0x642f8824
y.create.l HWIO_MSS_STMR_STATUS0_RD_ADDR A:0x642000c0
y.create.l HWIO_MSS_STMR_STATUS1_RD_ADDR A:0x642000c4
y.create.l HWIO_MSS_STMR_STATUS2_RD_ADDR A:0x642000c8
y.create.l HWIO_MSS_STMR_STATUS3_RD_ADDR A:0x642000cc
y.create.l HWIO_MSS_STMR_STATUS4_RD_ADDR A:0x642000d0
y.create.l HWIO_MSS_STMR_STATUS5_RD_ADDR A:0x642000d4
y.create.l HWIO_MSS_STMR_STATUS6_RD_ADDR A:0x642000d8
y.create.l HWIO_MSS_STMR_STATUS7_RD_ADDR A:0x642000dc
y.create.l HWIO_MSS_STMR_STATUS8_RD_ADDR A:0x642000e0
y.create.l HWIO_MSS_STMR_STATUS9_RD_ADDR A:0x642000e4
y.create.l HWIO_MSS_STMR_STATUS10_RD_ADDR A:0x642000e8
y.create.l HWIO_MSS_STMR_STATUS11_RD_ADDR A:0x642000ec
y.create.l HWIO_TX_ENABLE_ADDR A:0x64380000
y.create.l HWIO_TX_MEM_ACCESS_CFG_ADDR A:0x64380004
y.create.l HWIO_TX_MEM_PAGE_ADDR A:0x64380008
y.create.l HWIO_TX_AXI_WR_INTF_EVENT_ADDR A:0x6438000c
y.create.l HWIO_TX_STMR_TRIG_FRAC_CNT_0_ADDR A:0x64380010
y.create.l HWIO_TX_STMR_TRIG_FRAC_CNT_1_ADDR A:0x64380014
y.create.l HWIO_TX_FRAME_STB_FRAC_CNT_0_ADDR A:0x64380018
y.create.l HWIO_TX_FRAME_STB_FRAC_CNT_1_ADDR A:0x6438001c
y.create.l HWIO_TX_MISR_CTRL_ADDR A:0x64380020
y.create.l HWIO_TX_MISR_RD_DATA_ADDR A:0x64380024
y.create.l HWIO_TX_MISR_CAP_EN_ADDR A:0x64380028
y.create.l HWIO_HARQ_DONE_STATUS_ADDR A:0x6438002c
y.create.l HWIO_TX_MODE_0_ADDR A:0x64380030
y.create.l HWIO_TX_MODE_1_ADDR A:0x64380034
y.create.l HWIO_TX_MODE_COMMON_ADDR A:0x64380038
y.create.l HWIO_TX_ENABLE_GSM_0_ADDR A:0x6438003c
y.create.l HWIO_TX_ENABLE_GSM_1_ADDR A:0x64380040
y.create.l HWIO_TX_TDS_CTRL_ADDR A:0x64380044
y.create.l HWIO_TX_MEM_TEST_WR_ADDR_ADDR A:0x64380048
y.create.l HWIO_TX_MEM_TEST_WR_ADDR_STATUS_ADDR A:0x6438004c
y.create.l HWIO_TX_MEM_TEST_RD_ADDR A:0x64380050
y.create.l HWIO_TX_MEM_TEST_RD_ADDR_ADDR A:0x64380054
y.create.l HWIO_TX_MEM_TEST_RD_ADDR_STATUS_ADDR A:0x64380058
y.create.l HWIO_TX_SW_AHB_EVENT_ADDR0_ADDR A:0x64380060
y.create.l HWIO_TX_SW_AHB_EVENT_ADDR1_ADDR A:0x64380064
y.create.l HWIO_TX_SW_AHB_EVENT_ADDR2_ADDR A:0x64380068
y.create.l HWIO_TX_SW_AHB_EVENT_ADDR3_ADDR A:0x6438006c
y.create.l HWIO_TX_SW_AHB_EVENT_ADDR4_ADDR A:0x64380070
y.create.l HWIO_TX_SW_AHB_EVENT_ADDR5_ADDR A:0x64380074
y.create.l HWIO_TX_SW_AHB_EVENT_ADDR6_ADDR A:0x64380078
y.create.l HWIO_TX_SW_AHB_EVENT_ADDR7_ADDR A:0x6438007c
y.create.l HWIO_TX_A2_AHB_EVENT_ADDR_ADDR A:0x64380080
y.create.l HWIO_TX_EVENT_LOG_EN_ADDR A:0x64380084
y.create.l HWIO_TX_EVENT_SEL_0_ADDR A:0x64380088
y.create.l HWIO_TX_EVENT_SEL_1_ADDR A:0x6438008c
y.create.l HWIO_TX_TESTBUS_SEL_ADDR A:0x64380090
y.create.l HWIO_TX_TESTBUS_RD_DATA_ADDR A:0x64380094
y.create.l HWIO_TX_TESTBUS_RD_DATA_MASK_ADDR A:0x64380098
y.create.l HWIO_TX_ERROR_IRQ_EN_ADDR A:0x6438009c
y.create.l HWIO_TX_ERROR_IRQ_CLEAR_ADDR A:0x643800a0
y.create.l HWIO_TX_ERROR_IRQ_STATUS_ADDR A:0x643800a4
y.create.l HWIO_TX_STATUS_RD_ADDR A:0x643800a8
y.create.l HWIO_TX_DEBUG_IRQ_EN_ADDR A:0x643800ac
y.create.l HWIO_TX_DEBUG_IRQ_CLEAR_ADDR A:0x643800b0
y.create.l HWIO_TX_DEBUG_IRQ_STATUS_ADDR A:0x643800b4
y.create.l HWIO_TX_MODE_OFDMA_ADDR A:0x643800bc
y.create.l HWIO_TX_TECH_MUX_CTRL_ADDR A:0x643800c0
y.create.l HWIO_TX_AXI_RD0_INTF_CTL_ADDR A:0x643800c8
y.create.l HWIO_TX_AXI_RD0_INTF_EVENT_ADDR A:0x643800cc
y.create.l HWIO_TX_AXI_RD1_INTF_CTL_ADDR A:0x643800d0
y.create.l HWIO_TX_AXI_RD1_INTF_EVENT_ADDR A:0x643800d4
y.create.l HWIO_TX_SW_RESET_ENC_MOD_ADDR A:0x643800e0
y.create.l HWIO_TX_SW_RESET_TXC_TXR_0_ADDR A:0x643800e4
y.create.l HWIO_TX_SW_RESET_TXC_TXR_1_ADDR A:0x643800e8
y.create.l HWIO_TX_ENC_CLK_INIT_ADDR A:0x643800ec
y.create.l HWIO_TX_C2K_MODE_ADDR A:0x64381000
y.create.l HWIO_TX_TDS_NEW_FRAME_SW_ADDR A:0x64381064
y.create.l HWIO_TX_UNIFIED_DCH_RACH_ENC_TRIGGER_ADDR A:0x64381068
y.create.l HWIO_TX_TDS_ERUCCH_ENC_TRIGGER_ADDR A:0x6438106c
y.create.l HWIO_TX_1X_ENC_TRIGGER_ADDR A:0x64381070
y.create.l HWIO_TX_DO_ENC_TRIGGER_ADDR A:0x64381074
y.create.l HWIO_TX_DO_CARRIER_CONFIG_ADDR A:0x64381078
y.create.l HWIO_TX_UNIFIED_ENC_NUM_ACTIVE_TRCHS_ADDR A:0x6438107c
y.create.l HWIO_TX_UNIFIED_ENC_ENDIAN_FRMT_CTL_ADDR A:0x64381080
y.create.l HWIO_TX_UNIFIED_ENC_CIPHER_CK0_0_ADDR A:0x64381084
y.create.l HWIO_TX_UNIFIED_ENC_CIPHER_CK0_1_ADDR A:0x64381088
y.create.l HWIO_TX_UNIFIED_ENC_CIPHER_CK0_2_ADDR A:0x6438108c
y.create.l HWIO_TX_UNIFIED_ENC_CIPHER_CK0_3_ADDR A:0x64381090
y.create.l HWIO_TX_UNIFIED_ENC_CIPHER_CK1_0_ADDR A:0x64381094
y.create.l HWIO_TX_UNIFIED_ENC_CIPHER_CK1_1_ADDR A:0x64381098
y.create.l HWIO_TX_UNIFIED_ENC_CIPHER_CK1_2_ADDR A:0x6438109c
y.create.l HWIO_TX_UNIFIED_ENC_CIPHER_CK1_3_ADDR A:0x643810a0
y.create.l HWIO_TX_UNIFIED_ENC_CIPHER_CK2_0_ADDR A:0x643810a4
y.create.l HWIO_TX_UNIFIED_ENC_CIPHER_CK2_1_ADDR A:0x643810a8
y.create.l HWIO_TX_UNIFIED_ENC_CIPHER_CK2_2_ADDR A:0x643810ac
y.create.l HWIO_TX_UNIFIED_ENC_CIPHER_CK2_3_ADDR A:0x643810b0
y.create.l HWIO_TX_UNIFIED_ENC_CIPHER_CK3_0_ADDR A:0x643810b4
y.create.l HWIO_TX_UNIFIED_ENC_CIPHER_CK3_1_ADDR A:0x643810b8
y.create.l HWIO_TX_UNIFIED_ENC_CIPHER_CK3_2_ADDR A:0x643810bc
y.create.l HWIO_TX_UNIFIED_ENC_CIPHER_CK3_3_ADDR A:0x643810c0
y.create.l HWIO_TX_UNIFIED_ENC_CIPHER_CK4_0_ADDR A:0x643810c4
y.create.l HWIO_TX_UNIFIED_ENC_CIPHER_CK4_1_ADDR A:0x643810c8
y.create.l HWIO_TX_UNIFIED_ENC_CIPHER_CK4_2_ADDR A:0x643810cc
y.create.l HWIO_TX_UNIFIED_ENC_CIPHER_CK4_3_ADDR A:0x643810d0
y.create.l HWIO_TX_UNIFIED_ENC_CIPHER_CK5_0_ADDR A:0x643810d4
y.create.l HWIO_TX_UNIFIED_ENC_CIPHER_CK5_1_ADDR A:0x643810d8
y.create.l HWIO_TX_UNIFIED_ENC_CIPHER_CK5_2_ADDR A:0x643810dc
y.create.l HWIO_TX_UNIFIED_ENC_CIPHER_CK5_3_ADDR A:0x643810e0
y.create.l HWIO_TX_UNIFIED_ENC_ERAM_INCRACC_INIT_ADDR A:0x643810e4
y.create.l HWIO_TX_UNIFIED_ENC_FILLER_POLARITY_ADDR A:0x643810e8
y.create.l HWIO_TX_TDS_TTI_ERUCCH_ADDR A:0x643810ec
y.create.l HWIO_TX_UNIFIED_ENC_EUL_CODING_PARAM_BANK0_ADDR A:0x643810f0
y.create.l HWIO_TX_UNIFIED_ENC_EUL_CODING_PARAM_BANK1_ADDR A:0x643810f4
y.create.l HWIO_TX_UNIFIED_ENC_EUL_CODE_SEG_SIZE_BANK0_ADDR A:0x643810f8
y.create.l HWIO_TX_UNIFIED_ENC_EUL_CODE_SEG_SIZE_BANK1_ADDR A:0x643810fc
y.create.l HWIO_TX_UNIFIED_ENC_EUL_TURBO_INTLV_PARAM0_BANK0_ADDR A:0x64381100
y.create.l HWIO_TX_UNIFIED_ENC_EUL_TURBO_INTLV_PARAM0_BANK1_ADDR A:0x64381104
y.create.l HWIO_TX_UNIFIED_ENC_EUL_TURBO_INTLV_PARAM1_BANK0_ADDR A:0x64381108
y.create.l HWIO_TX_UNIFIED_ENC_EUL_TURBO_INTLV_PARAM1_BANK1_ADDR A:0x6438110c
y.create.l HWIO_TX_UNIFIED_ENC_OFFL_ENC_FRAME_ADDR A:0x64381110
y.create.l HWIO_TX_UNIFIED_EUL_ENC_TRIGGER_ADDR A:0x64381114
y.create.l HWIO_TX_UNIFIED_ENC_EUL_ENC_BANK_CFG_ADDR A:0x64381118
y.create.l HWIO_TX_1X_CH1_ENC_CTL_ADDR A:0x6438111c
y.create.l HWIO_TX_1X_CH1_CRC_POLY_ADDR A:0x64381120
y.create.l HWIO_TX_1X_CH2_ENC_CTL_0_ADDR A:0x64381124
y.create.l HWIO_TX_1X_CH2_ENC_CTL_1_ADDR A:0x64381128
y.create.l HWIO_TX_1X_CH2_CRC_POLY_ADDR A:0x6438112c
y.create.l HWIO_TX_1X_CH3_ENC_CTL_0_ADDR A:0x64381130
y.create.l HWIO_TX_1X_CH3_ENC_CTL_1_ADDR A:0x64381134
y.create.l HWIO_TX_1X_CH3_CRC_POLY_ADDR A:0x64381138
y.create.l HWIO_TX_DO_SCRAMB_INIT_0_ADDR A:0x6438113c
y.create.l HWIO_TX_TDS_RM_EINI_ERUCCH_ADDR A:0x64381148
y.create.l HWIO_TX_TDS_RM_EMINUS_ERUCCH_ADDR A:0x6438114c
y.create.l HWIO_TX_TDS_RM_EPLUS_ERUCCH_ADDR A:0x64381150
y.create.l HWIO_TX_TDS_CCTRCH_SI_ADDR A:0x64381154
y.create.l HWIO_TX_TDS_ERUCCH_ADDR_ADDR A:0x64381158
y.create.l HWIO_TX_TDS_CCTRCH_ADDR_ADDR A:0x6438115c
y.create.l HWIO_TX_TDS_SLOT_DATA_NUM0_CCTRCH1_ADDR A:0x64381160
y.create.l HWIO_TX_TDS_SLOT_DATA_NUM1_CCTRCH1_ADDR A:0x64381164
y.create.l HWIO_TX_TDS_SLOT_DATA_NUM2_CCTRCH1_ADDR A:0x64381168
y.create.l HWIO_TX_TDS_SLOT_DATA_NUM0_CCTRCH2_ADDR A:0x6438116c
y.create.l HWIO_TX_TDS_SLOT_DATA_NUM1_CCTRCH2_ADDR A:0x64381170
y.create.l HWIO_TX_TDS_SLOT_DATA_NUM2_CCTRCH2_ADDR A:0x64381174
y.create.l HWIO_TX_UNIFIED_ENC_EUL_RM_SYS_EINI_ADDR A:0x64381178
y.create.l HWIO_TX_UNIFIED_ENC_EUL_RM_SYS_EPLUS_EMINUS_ADDR A:0x6438117c
y.create.l HWIO_TX_UNIFIED_ENC_EUL_RM_P1_EINI_ADDR A:0x64381180
y.create.l HWIO_TX_UNIFIED_ENC_EUL_RM_P1_EPLUS_ADDR A:0x64381184
y.create.l HWIO_TX_UNIFIED_ENC_EUL_RM_P1_EMINUS_ADDR A:0x64381188
y.create.l HWIO_TX_UNIFIED_ENC_EUL_RM_P2_EINI_ADDR A:0x6438118c
y.create.l HWIO_TX_UNIFIED_ENC_EUL_RM_P2_EPLUS_EMINUS_ADDR A:0x64381190
y.create.l HWIO_TX_UNIFIED_ENC_EUL_RM_SYS_NUMBITS_ADDR A:0x64381194
y.create.l HWIO_TX_UNIFIED_ENC_EUL_RM_P1P2_NUMBITS_ADDR A:0x64381198
y.create.l HWIO_TX_TDS_EUL_NUMBITS_ADDR A:0x6438119c
y.create.l HWIO_UMTS_TX_EUL_RM_RAM_BASE_ADDR_ADDR A:0x643811a0
y.create.l HWIO_TX_1X_CH1_PUNCT_PATN_1_ADDR A:0x643811a4
y.create.l HWIO_TX_1X_CH1_PUNCT_PATN_0_ADDR A:0x643811a8
y.create.l HWIO_TX_1X_CH2_PUNCT_PATN_1_ADDR A:0x643811ac
y.create.l HWIO_TX_1X_CH2_PUNCT_PATN_0_ADDR A:0x643811b0
y.create.l HWIO_TX_1X_CH3_PUNCT_PATN_1_ADDR A:0x643811b4
y.create.l HWIO_TX_1X_CH3_PUNCT_PATN_0_ADDR A:0x643811b8
y.create.l HWIO_TX_1X_LPN_BOZO_ADDR A:0x643811bc
y.create.l HWIO_TX_UNIFIED_PN_LD_ADDR A:0x643811c0
y.create.l HWIO_TX_UNIFIED_PN_MASK_LD_ADDR A:0x643811c4
y.create.l HWIO_TX_1X_I_PN_STATE_ADDR A:0x643811c8
y.create.l HWIO_TX_1X_Q_PN_STATE_ADDR A:0x643811cc
y.create.l HWIO_TX_1X_U_PN_MASK_0_ADDR A:0x643811d0
y.create.l HWIO_TX_1X_U_PN_MASK_1_ADDR A:0x643811d4
y.create.l HWIO_TX_1X_U_PN_STATE_0_ADDR A:0x643811d8
y.create.l HWIO_TX_1X_U_PN_STATE_1_ADDR A:0x643811dc
y.create.l HWIO_TX_DO_PN_STATE_0_ADDR A:0x643811e0
y.create.l HWIO_TX_DO_PN_STATE_1_ADDR A:0x643811e4
y.create.l HWIO_TX_DO_I_PN_MASK_0_C0_ADDR A:0x643811e8
y.create.l HWIO_TX_DO_I_PN_MASK_1_C0_ADDR A:0x643811f4
y.create.l HWIO_TX_DO_Q_PN_MASK_0_C0_ADDR A:0x64381200
y.create.l HWIO_TX_DO_Q_PN_MASK_1_C0_ADDR A:0x6438120c
y.create.l HWIO_TX_DO_FOC_PN_CTL_C0_ADDR A:0x64381218
y.create.l HWIO_TX_DO_TRAFFIC_PN_CTL_ADDR A:0x64381224
y.create.l HWIO_TX_UMTS_SCR_CODE_INIT_ADDR A:0x64381228
y.create.l HWIO_TX_TDS_SCR_CODE_INIT_ADDR A:0x64381230
y.create.l HWIO_TX_1X_PICH_PCBIT_DATA_ADDR A:0x64381234
y.create.l HWIO_TX_1X_PICH_PCBIT_MASK_ADDR A:0x64381238
y.create.l HWIO_TX_DO_REV0_RRI_CTL_ADDR A:0x6438123c
y.create.l HWIO_TX_DO_ACK_CTL_C0_ADDR A:0x64381240
y.create.l HWIO_TX_DO_DRC_CTL_C0_ADDR A:0x6438124c
y.create.l HWIO_TX_DO_DSC_CTL_C0_ADDR A:0x64381258
y.create.l HWIO_TX_DO_REVAB_RRI_CTL_C0_ADDR A:0x64381264
y.create.l HWIO_TX_1X_FPC_BIT_ADDR A:0x64381270
y.create.l HWIO_TX_UMTS_PHY_CH_TYPE_ADDR A:0x64381274
y.create.l HWIO_TX_UMTS_RACH_CTL_ADDR A:0x64381278
y.create.l HWIO_TX_UMTS_RACH_OVSF_ADDR A:0x6438127c
y.create.l HWIO_TX_UMTS_CTL_CH_DATA_ADDR A:0x64381280
y.create.l HWIO_TX_UMTS_SPARE_CH_DATA_ADDR A:0x64381284
y.create.l HWIO_TX_UMTS_SPARE_CH_CTL_ADDR A:0x64381288
y.create.l HWIO_TX_UNIFIED_SPARE_DATA_CH_CTL_0_ADDR A:0x6438128c
y.create.l HWIO_TX_UNIFIED_SPARE_DATA_CH_CTL_1_ADDR A:0x64381290
y.create.l HWIO_TX_UNIFIED_SPARE_DATA_CH_FINE_CTL_0_ADDR A:0x64381294
y.create.l HWIO_TX_UNIFIED_SPARE_DATA_CH_FINE_CTL_1_ADDR A:0x64381298
y.create.l HWIO_TX_UMTS_DPDCH_CTL_ADDR A:0x6438129c
y.create.l HWIO_TX_UMTS_HSDPCCH_CTL_ADDR A:0x643812a0
y.create.l HWIO_TX_UMTS_HSDPCCH_DATA_ADDR A:0x643812a4
y.create.l HWIO_TX_UMTS_EUL_NUMBITS_EDPDCH0_ADDR A:0x643812a8
y.create.l HWIO_TX_UMTS_EUL_NUMBITS_EDPDCH1_ADDR A:0x643812ac
y.create.l HWIO_TX_UMTS_EUL_NUMBITS_EDPDCH2_ADDR A:0x643812b0
y.create.l HWIO_TX_UMTS_EUL_NUMBITS_EDPDCH3_ADDR A:0x643812b4
y.create.l HWIO_TX_UMTS_EUL_EDPDCH_CONFIG_ADDR A:0x643812c8
y.create.l HWIO_TX_UMTS_EUL_EDPDCH_CTL0_ADDR A:0x643812cc
y.create.l HWIO_TX_UMTS_EUL_EDPDCH_CTL1_ADDR A:0x643812d0
y.create.l HWIO_TX_UMTS_EUL_EDPDCH_CTL2_ADDR A:0x643812d4
y.create.l HWIO_TX_UMTS_EUL_EDPDCH_CTL3_ADDR A:0x643812d8
y.create.l HWIO_TX_UMTS_EUL_EDPCCH_CTL_ADDR A:0x643812dc
y.create.l HWIO_TX_UMTS_EUL_EDPCCH_DATA_ADDR A:0x643812e0
y.create.l HWIO_TX_TDS_EUCCH_ADDR A:0x643812e4
y.create.l HWIO_TX_TDS_HSSICH0_ADDR A:0x643812e8
y.create.l HWIO_TX_TDS_HSSICH1_ADDR A:0x643812ec
y.create.l HWIO_TX_TDS_HSSICH2_ADDR A:0x643812f0
y.create.l HWIO_TX_TDS_SYNC_UL0_ADDR A:0x643812f4
y.create.l HWIO_TX_TDS_SYNC_UL1_ADDR A:0x643812f8
y.create.l HWIO_TX_TDS_SYNC_UL2_ADDR A:0x643812fc
y.create.l HWIO_TX_TDS_SYNC_UL3_ADDR A:0x64381300
y.create.l HWIO_TX_TDS_MIDAMBLE_SHIFT_ADDR A:0x64381304
y.create.l HWIO_TX_TDS_MIDAMBLE0_ADDR A:0x64381308
y.create.l HWIO_TX_TDS_MIDAMBLE1_ADDR A:0x6438130c
y.create.l HWIO_TX_TDS_MIDAMBLE2_ADDR A:0x64381310
y.create.l HWIO_TX_TDS_MIDAMBLE3_ADDR A:0x64381314
y.create.l HWIO_TX_TDS_SLOT_CTL_PHY_CH0_ADDR A:0x64381318
y.create.l HWIO_TX_TDS_SLOT_CTL_PHY_CH1_ADDR A:0x6438131c
y.create.l HWIO_TX_TDS_SS_PHY_CH0_ADDR A:0x64381320
y.create.l HWIO_TX_TDS_SS_PHY_CH1_ADDR A:0x64381324
y.create.l HWIO_TX_TDS_TFCI_PHY_CH0_ADDR A:0x64381328
y.create.l HWIO_TX_TDS_TFCI_PHY_CH1_ADDR A:0x6438132c
y.create.l HWIO_TX_TDS_TPC_PHY_CH0_ADDR A:0x64381330
y.create.l HWIO_TX_TDS_TPC_PHY_CH1_ADDR A:0x64381334
y.create.l HWIO_TX_UNIFIED_NUM_ZEROS_FLUSH_ADDR A:0x64381338
y.create.l HWIO_TX_UNIFIED_FRAME_OFFSET_ADDR A:0x6438133c
y.create.l HWIO_TX_UNIFIED_FRAME_OFF_LD_ADDR A:0x64381340
y.create.l HWIO_TX_UNIFIED_SAMPLE_CNT_INIT_VAL_ADDR A:0x64381344
y.create.l HWIO_TX_UNIFIED_SAMPLE_CNT_LD_ADDR A:0x64381348
y.create.l HWIO_TX_UNIFIED_SAMPLE_CNT_READ_ADDR A:0x6438134c
y.create.l HWIO_TX_UNIFIED_SAMPLE_CNT_UPDATE_TIME_ADDR A:0x64381350
y.create.l HWIO_TX_UMTS_EUL_TTI_MODE_ADDR A:0x64381354
y.create.l HWIO_TX_UMTS_HSDPCCH_OFFSET_ADDR A:0x64381358
y.create.l HWIO_TX_UNIFIED_BETAP_GAIN_UPDATE_ADDR A:0x6438135c
y.create.l HWIO_TX_UNIFIED_PA_RANGE_UPDATE_ADDR A:0x64381360
y.create.l HWIO_TX_UNIFIED_OFFL_EN_ADDR A:0x64381364
y.create.l HWIO_TX_UNIFIED_DTX_EN_ADDR A:0x64381368
y.create.l HWIO_TX_UNIFIED_ERAM_CTL_ADDR A:0x6438136c
y.create.l HWIO_TX_TDS_EUL_RM_BANK_SEL_ADDR A:0x64381370
y.create.l HWIO_TX_UNIFIED_ENC_STATUS_ADDR A:0x64381374
y.create.l HWIO_TX_TDS_GUARD_PERIOD_ADDR A:0x64381378
y.create.l HWIO_TX_1X_DBR_MASK_READ_ADDR A:0x6438137c
y.create.l HWIO_TX_TDS_NEW_SUBFRAME_FW_ADDR A:0x64381380
y.create.l HWIO_TX_1X_MISC_CTL_ADDR A:0x64381384
y.create.l HWIO_TX_UNIFIED_CARRIER_EN_ADDR A:0x64381388
y.create.l HWIO_TX_DO_GAIN_BANK_ADDR A:0x6438138c
y.create.l HWIO_TX_UNIFIED_GAIN_0_ADDR A:0x64381390
y.create.l HWIO_TX_UNIFIED_GAIN_1_ADDR A:0x64381394
y.create.l HWIO_TX_UNIFIED_GAIN_2_ADDR A:0x64381398
y.create.l HWIO_TX_UNIFIED_GAIN_3_ADDR A:0x6438139c
y.create.l HWIO_TX_UNIFIED_GAIN_4_ADDR A:0x643813a0
y.create.l HWIO_TX_UNIFIED_GAIN_5_ADDR A:0x643813a4
y.create.l HWIO_TX_C2K_BETAP_GAIN_C0_ADDR A:0x643813a8
y.create.l HWIO_TX_UNIFIED_ADVRET_CMD_ADDR A:0x643813b4
y.create.l HWIO_TX_UNIFIED_ADVRET_TYPE_ADDR A:0x643813b8
y.create.l HWIO_TX_1X_MOD_WCOVER_SEL_ADDR A:0x643813bc
y.create.l HWIO_TX_DO_CTL_C0_ADDR A:0x643813c0
y.create.l HWIO_TX_TDS_NUM_DATA_PHY_CH0_ADDR A:0x643813cc
y.create.l HWIO_TX_TDS_NUM_DATA_PHY_CH1_ADDR A:0x643813d0
y.create.l HWIO_TX_TDS_SPR_FACTOR_CTL_ADDR A:0x643813d4
y.create.l HWIO_TX_TDS_EUL_MOD_CTL_ADDR A:0x643813d8
y.create.l HWIO_TX_TDS_SLOT_IDX_ADDR A:0x643813dc
y.create.l HWIO_TX_UMTS_DCH_RACH_LAST_ADDR A:0x643813e0
y.create.l HWIO_TX_UNIFIED_PRED_CLIP_BYPASS_ADDR A:0x643813e4
y.create.l HWIO_TX_UNIFIED_PRED_CLIP_C0_ADDR A:0x643813e8
y.create.l HWIO_TX_UNIFIED_PRED_CLIP_GLOBAL_ADDR A:0x643813f4
y.create.l HWIO_TX_TDS_BBF_WINDOW_ADDR A:0x643813f8
y.create.l HWIO_TX_UNIFIED_PA_RANGE_ADDR A:0x643813fc
y.create.l HWIO_TX_UNIFIED_ROTANGLE_0_ADDR A:0x64381400
y.create.l HWIO_TX_UNIFIED_ROTANGLE_1_ADDR A:0x64381404
y.create.l HWIO_TX_UNIFIED_ROT_FREQ_STEP_C0_ADDR A:0x64381408
y.create.l HWIO_TX_UNIFIED_CRC_BYPASS_ADDR A:0x64381414
y.create.l HWIO_TX_UNIFIED_MEM_PTR_EN_ADDR A:0x64381418
y.create.l HWIO_TX_MEM_ERAM_ADDR_0_ADDR A:0x6438145c
y.create.l HWIO_TX_MEM_ERAM_ADDR_1_ADDR A:0x64381460
y.create.l HWIO_TX_MEM_ERAM_ADDR_2_ADDR A:0x64381464
y.create.l HWIO_TX_MEM_ERAM_ADDR_3_ADDR A:0x64381468
y.create.l HWIO_TX_MEM_ERAM_ADDR_4_ADDR A:0x6438146c
y.create.l HWIO_TX_MEM_ERAM_ADDR_5_ADDR A:0x64381470
y.create.l HWIO_TX_MEM_ERAM_ADDR_6_ADDR A:0x64381474
y.create.l HWIO_TX_MEM_ERAM_ADDR_7_ADDR A:0x64381478
y.create.l HWIO_TX_MEM_ERAM_ADDR_8_ADDR A:0x6438147c
y.create.l HWIO_TX_MEM_ERAM_ADDR_9_ADDR A:0x64381480
y.create.l HWIO_TX_MEM_IRAM_ADDR_0_ADDR A:0x64381490
y.create.l HWIO_TX_MEM_IRAM_ADDR_1_ADDR A:0x64381494
y.create.l HWIO_TX_MEM_IRAM_ADDR_2_ADDR A:0x64381498
y.create.l HWIO_TX_MEM_IRAM_ADDR_3_ADDR A:0x6438149c
y.create.l HWIO_TX_MEM_IRAM_ADDR_4_ADDR A:0x643814a0
y.create.l HWIO_TX_MEM_IRAM_ADDR_5_ADDR A:0x643814a4
y.create.l HWIO_TX_MEM_IRAM_ADDR_6_ADDR A:0x643814a8
y.create.l HWIO_TX_MEM_IRAM_ADDR_7_ADDR A:0x643814ac
y.create.l HWIO_TX_MEM_IRAM_ADDR_8_ADDR A:0x643814b0
y.create.l HWIO_TX_MEM_IRAM_ADDR_9_ADDR A:0x643814b4
y.create.l HWIO_TX_SUMTS_DECIMATE_ADDR A:0x643814c4
y.create.l HWIO_TX_UNIFIED_ENC_TRBLK_PARAM_TRCH0_ADDR A:0x64381800
y.create.l HWIO_TX_UNIFIED_ENC_TRBLK_PARAM_TRCH1_ADDR A:0x64381804
y.create.l HWIO_TX_UNIFIED_ENC_TRBLK_PARAM_TRCH2_ADDR A:0x64381808
y.create.l HWIO_TX_UNIFIED_ENC_TRBLK_PARAM_TRCH3_ADDR A:0x6438180c
y.create.l HWIO_TX_UNIFIED_ENC_TRBLK_PARAM_TRCH4_ADDR A:0x64381810
y.create.l HWIO_TX_UNIFIED_ENC_TRBLK_PARAM_TRCH5_ADDR A:0x64381814
y.create.l HWIO_TX_UNIFIED_ENC_TRBLK_PARAM_TRCH6_ADDR A:0x64381818
y.create.l HWIO_TX_UNIFIED_ENC_TRBLK_PARAM_TRCH7_ADDR A:0x6438181c
y.create.l HWIO_TX_UNIFIED_ENC_ERAMB_ADDR_TRCH0_ADDR A:0x64381820
y.create.l HWIO_TX_UNIFIED_ENC_ERAMB_ADDR_TRCH1_ADDR A:0x64381824
y.create.l HWIO_TX_UNIFIED_ENC_ERAMB_ADDR_TRCH2_ADDR A:0x64381828
y.create.l HWIO_TX_UNIFIED_ENC_ERAMB_ADDR_TRCH3_ADDR A:0x6438182c
y.create.l HWIO_TX_UNIFIED_ENC_ERAMB_ADDR_TRCH4_ADDR A:0x64381830
y.create.l HWIO_TX_UNIFIED_ENC_ERAMB_ADDR_TRCH5_ADDR A:0x64381834
y.create.l HWIO_TX_UNIFIED_ENC_ERAMB_ADDR_TRCH6_ADDR A:0x64381838
y.create.l HWIO_TX_UNIFIED_ENC_ERAMB_ADDR_TRCH7_ADDR A:0x6438183c
y.create.l HWIO_TX_UNIFIED_ENC_CODING_PARAM_TRCH0_ADDR A:0x64381900
y.create.l HWIO_TX_UNIFIED_ENC_CODING_PARAM_TRCH1_ADDR A:0x64381904
y.create.l HWIO_TX_UNIFIED_ENC_CODING_PARAM_TRCH2_ADDR A:0x64381908
y.create.l HWIO_TX_UNIFIED_ENC_CODING_PARAM_TRCH3_ADDR A:0x6438190c
y.create.l HWIO_TX_UNIFIED_ENC_CODING_PARAM_TRCH4_ADDR A:0x64381910
y.create.l HWIO_TX_UNIFIED_ENC_CODING_PARAM_TRCH5_ADDR A:0x64381914
y.create.l HWIO_TX_UNIFIED_ENC_CODING_PARAM_TRCH6_ADDR A:0x64381918
y.create.l HWIO_TX_UNIFIED_ENC_CODING_PARAM_TRCH7_ADDR A:0x6438191c
y.create.l HWIO_TX_UNIFIED_ENC_CODE_SEG_SIZE_TRCH0_ADDR A:0x64381920
y.create.l HWIO_TX_UNIFIED_ENC_CODE_SEG_SIZE_TRCH1_ADDR A:0x64381924
y.create.l HWIO_TX_UNIFIED_ENC_CODE_SEG_SIZE_TRCH2_ADDR A:0x64381928
y.create.l HWIO_TX_UNIFIED_ENC_CODE_SEG_SIZE_TRCH3_ADDR A:0x6438192c
y.create.l HWIO_TX_UNIFIED_ENC_CODE_SEG_SIZE_TRCH4_ADDR A:0x64381930
y.create.l HWIO_TX_UNIFIED_ENC_CODE_SEG_SIZE_TRCH5_ADDR A:0x64381934
y.create.l HWIO_TX_UNIFIED_ENC_CODE_SEG_SIZE_TRCH6_ADDR A:0x64381938
y.create.l HWIO_TX_UNIFIED_ENC_CODE_SEG_SIZE_TRCH7_ADDR A:0x6438193c
y.create.l HWIO_TX_UNIFIED_ENC_RM_EINI_TRCH0_ADDR A:0x64381940
y.create.l HWIO_TX_UNIFIED_ENC_RM_EINI_TRCH1_ADDR A:0x64381944
y.create.l HWIO_TX_UNIFIED_ENC_RM_EINI_TRCH2_ADDR A:0x64381948
y.create.l HWIO_TX_UNIFIED_ENC_RM_EINI_TRCH3_ADDR A:0x6438194c
y.create.l HWIO_TX_UNIFIED_ENC_RM_EINI_TRCH4_ADDR A:0x64381950
y.create.l HWIO_TX_UNIFIED_ENC_RM_EINI_TRCH5_ADDR A:0x64381954
y.create.l HWIO_TX_UNIFIED_ENC_RM_EINI_TRCH6_ADDR A:0x64381958
y.create.l HWIO_TX_UNIFIED_ENC_RM_EINI_TRCH7_ADDR A:0x6438195c
y.create.l HWIO_TX_UNIFIED_ENC_RM_EMINUS_TRCH0_ADDR A:0x64381960
y.create.l HWIO_TX_UNIFIED_ENC_RM_EMINUS_TRCH1_ADDR A:0x64381964
y.create.l HWIO_TX_UNIFIED_ENC_RM_EMINUS_TRCH2_ADDR A:0x64381968
y.create.l HWIO_TX_UNIFIED_ENC_RM_EMINUS_TRCH3_ADDR A:0x6438196c
y.create.l HWIO_TX_UNIFIED_ENC_RM_EMINUS_TRCH4_ADDR A:0x64381970
y.create.l HWIO_TX_UNIFIED_ENC_RM_EMINUS_TRCH5_ADDR A:0x64381974
y.create.l HWIO_TX_UNIFIED_ENC_RM_EMINUS_TRCH6_ADDR A:0x64381978
y.create.l HWIO_TX_UNIFIED_ENC_RM_EMINUS_TRCH7_ADDR A:0x6438197c
y.create.l HWIO_TX_UNIFIED_ENC_RM_EPLUS_TRCH0_ADDR A:0x64381980
y.create.l HWIO_TX_UNIFIED_ENC_RM_EPLUS_TRCH1_ADDR A:0x64381984
y.create.l HWIO_TX_UNIFIED_ENC_RM_EPLUS_TRCH2_ADDR A:0x64381988
y.create.l HWIO_TX_UNIFIED_ENC_RM_EPLUS_TRCH3_ADDR A:0x6438198c
y.create.l HWIO_TX_UNIFIED_ENC_RM_EPLUS_TRCH4_ADDR A:0x64381990
y.create.l HWIO_TX_UNIFIED_ENC_RM_EPLUS_TRCH5_ADDR A:0x64381994
y.create.l HWIO_TX_UNIFIED_ENC_RM_EPLUS_TRCH6_ADDR A:0x64381998
y.create.l HWIO_TX_UNIFIED_ENC_RM_EPLUS_TRCH7_ADDR A:0x6438199c
y.create.l HWIO_TX_UNIFIED_ENC_TURBO_INTLV_PARAM0_TRCH0_ADDR A:0x643819a0
y.create.l HWIO_TX_UNIFIED_ENC_TURBO_INTLV_PARAM0_TRCH1_ADDR A:0x643819a4
y.create.l HWIO_TX_UNIFIED_ENC_TURBO_INTLV_PARAM0_TRCH2_ADDR A:0x643819a8
y.create.l HWIO_TX_UNIFIED_ENC_TURBO_INTLV_PARAM0_TRCH3_ADDR A:0x643819ac
y.create.l HWIO_TX_UNIFIED_ENC_TURBO_INTLV_PARAM0_TRCH4_ADDR A:0x643819b0
y.create.l HWIO_TX_UNIFIED_ENC_TURBO_INTLV_PARAM0_TRCH5_ADDR A:0x643819b4
y.create.l HWIO_TX_UNIFIED_ENC_TURBO_INTLV_PARAM0_TRCH6_ADDR A:0x643819b8
y.create.l HWIO_TX_UNIFIED_ENC_TURBO_INTLV_PARAM0_TRCH7_ADDR A:0x643819bc
y.create.l HWIO_TX_UNIFIED_ENC_TURBO_INTLV_PARAM1_TRCH0_ADDR A:0x643819c0
y.create.l HWIO_TX_UNIFIED_ENC_TURBO_INTLV_PARAM1_TRCH1_ADDR A:0x643819c4
y.create.l HWIO_TX_UNIFIED_ENC_TURBO_INTLV_PARAM1_TRCH2_ADDR A:0x643819c8
y.create.l HWIO_TX_UNIFIED_ENC_TURBO_INTLV_PARAM1_TRCH3_ADDR A:0x643819cc
y.create.l HWIO_TX_UNIFIED_ENC_TURBO_INTLV_PARAM1_TRCH4_ADDR A:0x643819d0
y.create.l HWIO_TX_UNIFIED_ENC_TURBO_INTLV_PARAM1_TRCH5_ADDR A:0x643819d4
y.create.l HWIO_TX_UNIFIED_ENC_TURBO_INTLV_PARAM1_TRCH6_ADDR A:0x643819d8
y.create.l HWIO_TX_UNIFIED_ENC_TURBO_INTLV_PARAM1_TRCH7_ADDR A:0x643819dc
y.create.l HWIO_TX_UNIFIED_ENC_ERAM_DATA_INCRACC_0_ADDR A:0x64381a00
y.create.l HWIO_TX_UNIFIED_ENC_ERAM_DATA_INCRACC_1_ADDR A:0x64381a04
y.create.l HWIO_TX_UNIFIED_ENC_ERAM_DATA_INCRACC_2_ADDR A:0x64381a08
y.create.l HWIO_TX_UNIFIED_ENC_ERAM_DATA_INCRACC_3_ADDR A:0x64381a0c
y.create.l HWIO_TX_UNIFIED_ENC_TRCH_MUX_ORDER_CCTRCH1_ADDR A:0x64381a20
y.create.l HWIO_TX_TDS_TRCH_MUX_ORDER_CCTRCH2_ADDR A:0x64381a40
y.create.l HWIO_TX_TDS_DPCH0_LAST_SLOT0_BANK0_ADDR A:0x64381b00
y.create.l HWIO_TX_TDS_DPCH0_LAST_SLOT1_BANK0_ADDR A:0x64381b04
y.create.l HWIO_TX_TDS_DPCH0_LAST_SLOT2_BANK0_ADDR A:0x64381b08
y.create.l HWIO_TX_TDS_DPCH0_LAST_SLOT3_BANK0_ADDR A:0x64381b0c
y.create.l HWIO_TX_TDS_DPCH0_LAST_SLOT4_BANK0_ADDR A:0x64381b10
y.create.l HWIO_TX_TDS_DPCH0_SLOT0_BANK0_ADDR A:0x64381b40
y.create.l HWIO_TX_TDS_DPCH0_SLOT1_BANK0_ADDR A:0x64381b44
y.create.l HWIO_TX_TDS_DPCH0_SLOT2_BANK0_ADDR A:0x64381b48
y.create.l HWIO_TX_TDS_DPCH0_SLOT3_BANK0_ADDR A:0x64381b4c
y.create.l HWIO_TX_TDS_DPCH0_SLOT4_BANK0_ADDR A:0x64381b50
y.create.l HWIO_TX_TDS_DPCH0_SLOT5_BANK0_ADDR A:0x64381b54
y.create.l HWIO_TX_TDS_DPCH0_SLOT6_BANK0_ADDR A:0x64381b58
y.create.l HWIO_TX_TDS_DPCH0_SLOT7_BANK0_ADDR A:0x64381b5c
y.create.l HWIO_TX_TDS_DPCH0_SLOT8_BANK0_ADDR A:0x64381b60
y.create.l HWIO_TX_TDS_DPCH0_SLOT9_BANK0_ADDR A:0x64381b64
y.create.l HWIO_TX_TDS_DPCH1_LAST_SLOT0_BANK0_ADDR A:0x64381b80
y.create.l HWIO_TX_TDS_DPCH1_LAST_SLOT1_BANK0_ADDR A:0x64381b84
y.create.l HWIO_TX_TDS_DPCH1_LAST_SLOT2_BANK0_ADDR A:0x64381b88
y.create.l HWIO_TX_TDS_DPCH1_LAST_SLOT3_BANK0_ADDR A:0x64381b8c
y.create.l HWIO_TX_TDS_DPCH1_LAST_SLOT4_BANK0_ADDR A:0x64381b90
y.create.l HWIO_TX_TDS_DPCH1_SLOT0_BANK0_ADDR A:0x64381bc0
y.create.l HWIO_TX_TDS_DPCH1_SLOT1_BANK0_ADDR A:0x64381bc4
y.create.l HWIO_TX_TDS_DPCH1_SLOT2_BANK0_ADDR A:0x64381bc8
y.create.l HWIO_TX_TDS_DPCH1_SLOT3_BANK0_ADDR A:0x64381bcc
y.create.l HWIO_TX_TDS_DPCH1_SLOT4_BANK0_ADDR A:0x64381bd0
y.create.l HWIO_TX_TDS_DPCH1_SLOT5_BANK0_ADDR A:0x64381bd4
y.create.l HWIO_TX_TDS_DPCH1_SLOT6_BANK0_ADDR A:0x64381bd8
y.create.l HWIO_TX_TDS_DPCH1_SLOT7_BANK0_ADDR A:0x64381bdc
y.create.l HWIO_TX_TDS_DPCH1_SLOT8_BANK0_ADDR A:0x64381be0
y.create.l HWIO_TX_TDS_DPCH1_SLOT9_BANK0_ADDR A:0x64381be4
y.create.l HWIO_TX_TDS_EPUCH_LAST_BANK0_ADDR A:0x64381c00
y.create.l HWIO_TX_TDS_EPUCH_SLOT0_BANK0_ADDR A:0x64381c20
y.create.l HWIO_TX_TDS_EPUCH_SLOT1_BANK0_ADDR A:0x64381c24
y.create.l HWIO_TX_TDS_EPUCH_SLOT2_BANK0_ADDR A:0x64381c28
y.create.l HWIO_TX_TDS_EPUCH_SLOT3_BANK0_ADDR A:0x64381c2c
y.create.l HWIO_TX_TDS_EPUCH_SLOT4_BANK0_ADDR A:0x64381c30
y.create.l HWIO_TX_TDS_ERUCCH_LAST_BANK0_ADDR A:0x64381c40
y.create.l HWIO_TX_TDS_ERUCCH_SUBFRAME0_BANK0_ADDR A:0x64381c60
y.create.l HWIO_TX_TDS_ERUCCH_SUBFRAME1_BANK0_ADDR A:0x64381c64
y.create.l HWIO_TX_TDS_DPCH0_LAST_SLOT0_BANK1_ADDR A:0x64381ca0
y.create.l HWIO_TX_TDS_DPCH0_LAST_SLOT1_BANK1_ADDR A:0x64381ca4
y.create.l HWIO_TX_TDS_DPCH0_LAST_SLOT2_BANK1_ADDR A:0x64381ca8
y.create.l HWIO_TX_TDS_DPCH0_LAST_SLOT3_BANK1_ADDR A:0x64381cac
y.create.l HWIO_TX_TDS_DPCH0_LAST_SLOT4_BANK1_ADDR A:0x64381cb0
y.create.l HWIO_TX_TDS_DPCH0_SLOT0_BANK1_ADDR A:0x64381cc0
y.create.l HWIO_TX_TDS_DPCH0_SLOT1_BANK1_ADDR A:0x64381cc4
y.create.l HWIO_TX_TDS_DPCH0_SLOT2_BANK1_ADDR A:0x64381cc8
y.create.l HWIO_TX_TDS_DPCH0_SLOT3_BANK1_ADDR A:0x64381ccc
y.create.l HWIO_TX_TDS_DPCH0_SLOT4_BANK1_ADDR A:0x64381cd0
y.create.l HWIO_TX_TDS_DPCH0_SLOT5_BANK1_ADDR A:0x64381cd4
y.create.l HWIO_TX_TDS_DPCH0_SLOT6_BANK1_ADDR A:0x64381cd8
y.create.l HWIO_TX_TDS_DPCH0_SLOT7_BANK1_ADDR A:0x64381cdc
y.create.l HWIO_TX_TDS_DPCH0_SLOT8_BANK1_ADDR A:0x64381ce0
y.create.l HWIO_TX_TDS_DPCH0_SLOT9_BANK1_ADDR A:0x64381ce4
y.create.l HWIO_TX_TDS_DPCH1_LAST_SLOT0_BANK1_ADDR A:0x64381d00
y.create.l HWIO_TX_TDS_DPCH1_LAST_SLOT1_BANK1_ADDR A:0x64381d04
y.create.l HWIO_TX_TDS_DPCH1_LAST_SLOT2_BANK1_ADDR A:0x64381d08
y.create.l HWIO_TX_TDS_DPCH1_LAST_SLOT3_BANK1_ADDR A:0x64381d0c
y.create.l HWIO_TX_TDS_DPCH1_LAST_SLOT4_BANK1_ADDR A:0x64381d10
y.create.l HWIO_TX_TDS_DPCH1_SLOT0_BANK1_ADDR A:0x64381d40
y.create.l HWIO_TX_TDS_DPCH1_SLOT1_BANK1_ADDR A:0x64381d44
y.create.l HWIO_TX_TDS_DPCH1_SLOT2_BANK1_ADDR A:0x64381d48
y.create.l HWIO_TX_TDS_DPCH1_SLOT3_BANK1_ADDR A:0x64381d4c
y.create.l HWIO_TX_TDS_DPCH1_SLOT4_BANK1_ADDR A:0x64381d50
y.create.l HWIO_TX_TDS_DPCH1_SLOT5_BANK1_ADDR A:0x64381d54
y.create.l HWIO_TX_TDS_DPCH1_SLOT6_BANK1_ADDR A:0x64381d58
y.create.l HWIO_TX_TDS_DPCH1_SLOT7_BANK1_ADDR A:0x64381d5c
y.create.l HWIO_TX_TDS_DPCH1_SLOT8_BANK1_ADDR A:0x64381d60
y.create.l HWIO_TX_TDS_DPCH1_SLOT9_BANK1_ADDR A:0x64381d64
y.create.l HWIO_TX_TDS_EPUCH_LAST_BANK1_ADDR A:0x64381d80
y.create.l HWIO_TX_TDS_EPUCH_SLOT0_BANK1_ADDR A:0x64381da0
y.create.l HWIO_TX_TDS_EPUCH_SLOT1_BANK1_ADDR A:0x64381da4
y.create.l HWIO_TX_TDS_EPUCH_SLOT2_BANK1_ADDR A:0x64381da8
y.create.l HWIO_TX_TDS_EPUCH_SLOT3_BANK1_ADDR A:0x64381dac
y.create.l HWIO_TX_TDS_EPUCH_SLOT4_BANK1_ADDR A:0x64381db0
y.create.l HWIO_TX_TDS_ERUCCH_LAST_BANK1_ADDR A:0x64381dc0
y.create.l HWIO_TX_TDS_ERUCCH_SUBFRAME0_BANK1_ADDR A:0x64381de0
y.create.l HWIO_TX_TDS_ERUCCH_SUBFRAME1_BANK1_ADDR A:0x64381de4
y.create.l HWIO_TX_DO_GAIN_0_1_C0_BANK0_ADDR A:0x64381e00
y.create.l HWIO_TX_DO_GAIN_2_3_C0_BANK0_ADDR A:0x64381e0c
y.create.l HWIO_TX_DO_GAIN_4_5_C0_BANK0_ADDR A:0x64381e18
y.create.l HWIO_TX_DO_GAIN_6_7_C0_BANK0_ADDR A:0x64381e24
y.create.l HWIO_TX_DO_GAIN_8_9_C0_BANK0_ADDR A:0x64381e30
y.create.l HWIO_TX_DO_GAIN_0_1_C0_BANK1_ADDR A:0x64381f00
y.create.l HWIO_TX_DO_GAIN_2_3_C0_BANK1_ADDR A:0x64381f0c
y.create.l HWIO_TX_DO_GAIN_4_5_C0_BANK1_ADDR A:0x64381f18
y.create.l HWIO_TX_DO_GAIN_6_7_C0_BANK1_ADDR A:0x64381f24
y.create.l HWIO_TX_DO_GAIN_8_9_C0_BANK1_ADDR A:0x64381f30
y.create.l HWIO_TX_MEM_START_ADDR A:0x64382000
y.create.l HWIO_TX_RDR0_CFG0_ADDR A:0x64383000
y.create.l HWIO_TX_RDR1_CFG0_ADDR A:0x64383008
y.create.l HWIO_TX_RDR0_CFG1_ADDR A:0x64383004
y.create.l HWIO_TX_RDR1_CFG1_ADDR A:0x6438300c
y.create.l HWIO_TX_RDR0_XFER_CTL_ADDR A:0x64383010
y.create.l HWIO_TX_RDR1_XFER_CTL_ADDR A:0x64383014
y.create.l HWIO_TX_WRTR_CFG0_ADDR A:0x64383018
y.create.l HWIO_TX_WRTR_CFG1_ADDR A:0x6438301c
y.create.l HWIO_TX_WRTR_XFER_CTL_ADDR A:0x64383020
y.create.l HWIO_TX_BRDG_CTL_ADDR A:0x64383024
y.create.l HWIO_TX_BRDG_STATUS_ADDR A:0x64383028
y.create.l HWIO_TX_BRDG_CLEAR_ADDR A:0x6438302c
y.create.l HWIO_TX_BRDG_ARB_PRI_ADDR A:0x64383030
y.create.l HWIO_TX_RDR0_VBUF_ADDR_ADDR A:0x64383034
y.create.l HWIO_TX_RDR1_VBUF_ADDR_ADDR A:0x64383038
y.create.l HWIO_TX_WRTR_VBUF_ADDR_ADDR A:0x6438303c
y.create.l HWIO_TX_BRDG_AXI_PRI_ADDR A:0x64383040
y.create.l HWIO_TXR_IQ_DAC_A0_ADDR A:0x64385000
y.create.l HWIO_TXR_STR_CTRL_A0_ADDR A:0x64385008
y.create.l HWIO_TXR_PDA_CTRL_A0_ADDR A:0x6438500c
y.create.l HWIO_TXR_PDA_WD_UPDATE_CTRL_A0_ADDR A:0x64385010
y.create.l HWIO_TXR_PDA_CTRL_WD_OFFSET_A0_ADDR A:0x64385014
y.create.l HWIO_TXR_PDA_OFFSET_CMD_A0_ADDR A:0x64385018
y.create.l HWIO_TXR_PPDSM_CTL_A0_ADDR A:0x6438501c
y.create.l HWIO_TXR_PPDSM_OVERRIDE_VAL_A0_ADDR A:0x64385020
y.create.l HWIO_TXR_PPDSM_OVERRIDE_REP_A0_ADDR A:0x64385024
y.create.l HWIO_TXR_FIFO_PTR_DIFF_A_A0_ADDR A:0x64385028
y.create.l HWIO_TXR_FIFO_PTR_DIFF_B_A0_ADDR A:0x6438502c
y.create.l HWIO_TXR_FIFO_STATUS_A_A0_ADDR A:0x64385030
y.create.l HWIO_TXR_FIFO_STATUS_B_A0_ADDR A:0x64385034
y.create.l HWIO_TXR_FIFO_CMD_A0_ADDR A:0x64385038
y.create.l HWIO_TXR_FIFO_CTRL_A0_ADDR A:0x6438503c
y.create.l HWIO_TXR_STREAM_IF_CTRL_A0_ADDR A:0x64385040
y.create.l HWIO_TXR_FMT_CONV_CTL_A0_ADDR A:0x64385050
y.create.l HWIO_TXR_TEST_BUS_IN_IQ_SWAP_A0_ADDR A:0x64385054
y.create.l HWIO_TXR_TEST_BUS_OUT_IQ_SWAP_A0_ADDR A:0x64385058
y.create.l HWIO_TXR_IQ_DAC_CURRENT_A0_ADDR A:0x6438505c
y.create.l HWIO_TXR_STR_CTRL_CURRENT_A0_ADDR A:0x64385060
y.create.l HWIO_TXR_PDA_CTRL_CURRENT_A0_ADDR A:0x64385064
y.create.l HWIO_TXR_PDA_WD_UPDATE_CTRL_CURRENT_A0_ADDR A:0x64385068
y.create.l HWIO_TXR_PDA_CTRL_WD_OFFSET_CURRENT_A0_ADDR A:0x6438506c
y.create.l HWIO_TXR_PDA_OFFSET_CMD_CURRENT_A0_ADDR A:0x64385070
y.create.l HWIO_TXR_PPDSM_CTL_CURRENT_A0_ADDR A:0x64385074
y.create.l HWIO_TXR_PPDSM_OVERRIDE_VAL_CURRENT_A0_ADDR A:0x64385078
y.create.l HWIO_TXR_PPDSM_OVERRIDE_REP_CURRENT_A0_ADDR A:0x6438507c
y.create.l HWIO_TXR_STREAM_IF_CTRL_CURRENT_A0_ADDR A:0x64385080
y.create.l HWIO_TXR_FMT_CONV_CTL_CURRENT_A0_ADDR A:0x64385084
y.create.l HWIO_TXC_DP_CFG_A1_ADDR A:0x64386004
y.create.l HWIO_TXC_DP_ENV_SCALE_VAL_A1_ADDR A:0x64386010
y.create.l HWIO_TXC_DP_ENV_SCALE_VAL_SET2_A1_ADDR A:0x64386014
y.create.l HWIO_TXC_DP_RAMP_ARM_A1_ADDR A:0x64386024
y.create.l HWIO_TXC_DP_RAMP_START_TIME_A1_ADDR A:0x64386028
y.create.l HWIO_TXC_DP_RAMP_SLOT_A_CFG_A1_ADDR A:0x64386038
y.create.l HWIO_TXC_DP_RAMP_SLOT_B_CFG_A1_ADDR A:0x6438603c
y.create.l HWIO_TXC_DP_RAMP_GAP_A1_ADDR A:0x64386040
y.create.l HWIO_TXC_DP_RAMP_SLOT_A_CFG_ACT_A1_ADDR A:0x64386044
y.create.l HWIO_TXC_DP_RAMP_SLOT_B_CFG_ACT_A1_ADDR A:0x64386048
y.create.l HWIO_TXC_DP_RAMP_GAP_ACT_A1_ADDR A:0x6438604c
y.create.l HWIO_TXC_DP_PHASE_OVR_VAL_A1_ADDR A:0x64386080
y.create.l HWIO_TXC_PP_PHASE_OVR_VAL_A1_ADDR A:0x64386084
y.create.l HWIO_TXC_DP_ENV_OVR_VAL_A1_ADDR A:0x64386088
y.create.l HWIO_TXC_EP_ENV_OVR_VAL_A1_ADDR A:0x6438608c
y.create.l HWIO_TXC_EP_ENV_OVR_VAL_SET2_A1_ADDR A:0x64386090
y.create.l HWIO_TXC_DP_ROT_PHASE_INC_A1_ADDR A:0x643860a0
y.create.l HWIO_TXC_DP_ROT_PHASE_INC_SET2_A1_ADDR A:0x643860a4
y.create.l HWIO_TXC_DP_ROT_PHASE_INIT_A1_ADDR A:0x643860a8
y.create.l HWIO_TXC_DP_ROT_PHASE_INIT_SET2_A1_ADDR A:0x643860ac
y.create.l HWIO_TXC_DP_ROT_PHASE_SHIFT_A1_ADDR A:0x643860b0
y.create.l HWIO_TXC_DP_ROT_PHASE_SHIFT_SET2_A1_ADDR A:0x643860b4
y.create.l HWIO_TXC_DM1_CFG_A1_ADDR A:0x64386100
y.create.l HWIO_TXC_EP_GAIN_A1_ADDR A:0x64386160
y.create.l HWIO_TXC_EP_GAIN_SET2_A1_ADDR A:0x64386164
y.create.l HWIO_TXC_EP_DCOC_A1_ADDR A:0x64386170
y.create.l HWIO_TXC_EP_DCOC_SET2_A1_ADDR A:0x64386174
y.create.l HWIO_TXC_EP_DM2_FINE_TAU_A1_ADDR A:0x64386178
y.create.l HWIO_TXC_EP_DM3_FRAC_TAU_A1_ADDR A:0x6438617c
y.create.l HWIO_TXC_PP_GAIN_A1_ADDR A:0x64386180
y.create.l HWIO_TXC_PP_SPILL_A1_ADDR A:0x64386190
y.create.l HWIO_TXC_TIMESTAMP_T1_A1_ADDR A:0x643861a0
y.create.l HWIO_TXC_TIMESTAMP_T2_A1_ADDR A:0x643861a8
y.create.l HWIO_TXC_TIMESTAMP_REUSE_A1_ADDR A:0x643861b0
y.create.l HWIO_TXC_SAMPLE_COUNT_A1_ADDR A:0x643861b4
y.create.l HWIO_TXC_SAMPLE_COUNT_CTL_A1_ADDR A:0x643861b8
y.create.l HWIO_TXC_REF_ARM_A1_ADDR A:0x643861c0
y.create.l HWIO_TXC_REF_DWN_FACTOR_A1_ADDR A:0x643861c4
y.create.l HWIO_TXC_REF_NUM_SAMPLES_A1_ADDR A:0x643861c8
y.create.l HWIO_TXC_REF_START_TIME_A1_ADDR A:0x643861cc
y.create.l HWIO_TXC_REF_STATUS_A1_ADDR A:0x643861d0
y.create.l HWIO_TXC_REF_PEAK_POWER_A1_ADDR A:0x643861d4
y.create.l HWIO_TXC_REF_RMS_POWER_M_A1_ADDR A:0x643861d8
y.create.l HWIO_TXC_REF_RMS_POWER_L_A1_ADDR A:0x643861dc
y.create.l HWIO_TXC_REF_MODE_A1_ADDR A:0x643861e0
y.create.l HWIO_TXC_REF_I_GAIN_VAL_A1_ADDR A:0x643861e4
y.create.l HWIO_TXC_REF_Q_GAIN_VAL_A1_ADDR A:0x643861e8
y.create.l HWIO_TXC_REF_POWERCALC_OR_LOG_A1_ADDR A:0x643861ec
y.create.l HWIO_TXC_TESTBUS_SELECT_A1_ADDR A:0x643861f0
y.create.l HWIO_TXC_TEST_BUS_IN_IQ_SWAP_A1_ADDR A:0x643861f4
y.create.l HWIO_TXC_TEST_BUS_OUT_IQ_SWAP_A1_ADDR A:0x643861f8
y.create.l HWIO_TXC_AMAM_PENDING_A1_ADDR A:0x64386220
y.create.l HWIO_TXC_AMPM_PENDING_A1_ADDR A:0x64386224
y.create.l HWIO_TXC_AMAM_PENDING_SET2_A1_ADDR A:0x64386230
y.create.l HWIO_TXC_AMPM_PENDING_SET2_A1_ADDR A:0x64386234
y.create.l HWIO_TXC_AMAM_ACTIVE_A1_ADDR A:0x64386240
y.create.l HWIO_TXC_AMPM_ACTIVE_A1_ADDR A:0x64386244
y.create.l HWIO_TXC_RAMP_ACTIVE_A1_ADDR A:0x6438624c
y.create.l HWIO_TXC_REF_POWER_SUM_I_A1_ADDR A:0x643862e0
y.create.l HWIO_TXC_REF_POWER_SUM_Q_A1_ADDR A:0x643862e4
y.create.l HWIO_TXC_REF_POWER_SUM_IQ_M_A1_ADDR A:0x643862e8
y.create.l HWIO_TXC_REF_POWER_SUM_IQ_L_A1_ADDR A:0x643862ec
y.create.l HWIO_TXC_REF_POWER_SUM_QQ_M_A1_ADDR A:0x643862f0
y.create.l HWIO_TXC_REF_POWER_SUM_QQ_L_A1_ADDR A:0x643862f4
y.create.l HWIO_TXC_DP_CFG_LATCHED_A1_ADDR A:0x64386300
y.create.l HWIO_TXC_DP_ENV_SCALE_VAL_LATCHED_A1_ADDR A:0x64386304
y.create.l HWIO_TXC_DP_PHASE_OVR_VAL_LATCHED_A1_ADDR A:0x64386308
y.create.l HWIO_TXC_PP_PHASE_OVR_VAL_LATCHED_A1_ADDR A:0x6438630c
y.create.l HWIO_TXC_DP_ENV_OVR_VAL_LATCHED_A1_ADDR A:0x64386310
y.create.l HWIO_TXC_EP_ENV_OVR_VAL_LATCHED_A1_ADDR A:0x64386314
y.create.l HWIO_TXC_DP_ROT_PHASE_INC_LATCHED_A1_ADDR A:0x64386318
y.create.l HWIO_TXC_DP_ROT_PHASE_INIT_LATCHED_A1_ADDR A:0x6438631c
y.create.l HWIO_TXC_DP_ROT_PHASE_SHIFT_LATCHED_A1_ADDR A:0x64386320
y.create.l HWIO_TXC_DM1_CFG_LATCHED_A1_ADDR A:0x64386338
y.create.l HWIO_TXC_EP_GAIN_LATCHED_A1_ADDR A:0x6438633c
y.create.l HWIO_TXC_EP_DCOC_LATCHED_A1_ADDR A:0x64386344
y.create.l HWIO_TXC_EP_DM2_FINE_TAU_LATCHED_A1_ADDR A:0x64386348
y.create.l HWIO_TXC_EP_DM3_FRAC_TAU_LATCHED_A1_ADDR A:0x6438634c
y.create.l HWIO_TXC_PP_GAIN_LATCHED_A1_ADDR A:0x64386350
y.create.l HWIO_TXC_PP_SPILL_LATCHED_A1_ADDR A:0x64386354
y.create.l HWIO_TXR_IQ_DAC_A1_ADDR A:0x64387000
y.create.l HWIO_TXR_STR_CTRL_A1_ADDR A:0x64387008
y.create.l HWIO_TXR_PDA_CTRL_A1_ADDR A:0x6438700c
y.create.l HWIO_TXR_PDA_WD_UPDATE_CTRL_A1_ADDR A:0x64387010
y.create.l HWIO_TXR_PDA_CTRL_WD_OFFSET_A1_ADDR A:0x64387014
y.create.l HWIO_TXR_PDA_OFFSET_CMD_A1_ADDR A:0x64387018
y.create.l HWIO_TXR_PPDSM_CTL_A1_ADDR A:0x6438701c
y.create.l HWIO_TXR_PPDSM_OVERRIDE_VAL_A1_ADDR A:0x64387020
y.create.l HWIO_TXR_PPDSM_OVERRIDE_REP_A1_ADDR A:0x64387024
y.create.l HWIO_TXR_FIFO_PTR_DIFF_A_A1_ADDR A:0x64387028
y.create.l HWIO_TXR_FIFO_PTR_DIFF_B_A1_ADDR A:0x6438702c
y.create.l HWIO_TXR_FIFO_STATUS_A_A1_ADDR A:0x64387030
y.create.l HWIO_TXR_FIFO_STATUS_B_A1_ADDR A:0x64387034
y.create.l HWIO_TXR_FIFO_CMD_A1_ADDR A:0x64387038
y.create.l HWIO_TXR_FIFO_CTRL_A1_ADDR A:0x6438703c
y.create.l HWIO_TXR_STREAM_IF_CTRL_A1_ADDR A:0x64387040
y.create.l HWIO_TXR_FMT_CONV_CTL_A1_ADDR A:0x64387050
y.create.l HWIO_TXR_TEST_BUS_IN_IQ_SWAP_A1_ADDR A:0x64387054
y.create.l HWIO_TXR_TEST_BUS_OUT_IQ_SWAP_A1_ADDR A:0x64387058
y.create.l HWIO_TXR_IQ_DAC_CURRENT_A1_ADDR A:0x6438705c
y.create.l HWIO_TXR_STR_CTRL_CURRENT_A1_ADDR A:0x64387060
y.create.l HWIO_TXR_PDA_CTRL_CURRENT_A1_ADDR A:0x64387064
y.create.l HWIO_TXR_PDA_WD_UPDATE_CTRL_CURRENT_A1_ADDR A:0x64387068
y.create.l HWIO_TXR_PDA_CTRL_WD_OFFSET_CURRENT_A1_ADDR A:0x6438706c
y.create.l HWIO_TXR_PDA_OFFSET_CMD_CURRENT_A1_ADDR A:0x64387070
y.create.l HWIO_TXR_PPDSM_CTL_CURRENT_A1_ADDR A:0x64387074
y.create.l HWIO_TXR_PPDSM_OVERRIDE_VAL_CURRENT_A1_ADDR A:0x64387078
y.create.l HWIO_TXR_PPDSM_OVERRIDE_REP_CURRENT_A1_ADDR A:0x6438707c
y.create.l HWIO_TXR_STREAM_IF_CTRL_CURRENT_A1_ADDR A:0x64387080
y.create.l HWIO_TXR_FMT_CONV_CTL_CURRENT_A1_ADDR A:0x64387084
y.create.l HWIO_TXC_TECH_SEL_A0_ADDR A:0x64384000
y.create.l HWIO_TXC_DP_CFG_A0_ADDR A:0x64384004
y.create.l HWIO_TXC_DP_CFG_2_A0_ADDR A:0x64384008
y.create.l HWIO_TXC_DP_ENV_SCALE_VAL_A0_ADDR A:0x64384010
y.create.l HWIO_TXC_DP_ENV_SCALE_VAL_SET2_A0_ADDR A:0x64384014
y.create.l HWIO_TXC_DP_ENV_SCALE_VAL_IMM_A0_ADDR A:0x64384018
y.create.l HWIO_TXC_DP_RAMP_ARM_A0_ADDR A:0x64384024
y.create.l HWIO_TXC_DP_RAMP_START_TIME_A0_ADDR A:0x64384028
y.create.l HWIO_TXC_DP_RAMP_SLOT_A_CFG_A0_ADDR A:0x64384038
y.create.l HWIO_TXC_DP_RAMP_SLOT_B_CFG_A0_ADDR A:0x6438403c
y.create.l HWIO_TXC_DP_RAMP_GAP_A0_ADDR A:0x64384040
y.create.l HWIO_TXC_DP_RAMP_SLOT_A_CFG_ACT_A0_ADDR A:0x64384044
y.create.l HWIO_TXC_DP_RAMP_SLOT_B_CFG_ACT_A0_ADDR A:0x64384048
y.create.l HWIO_TXC_DP_RAMP_GAP_ACT_A0_ADDR A:0x6438404c
y.create.l HWIO_TXC_DP_PHASE_OVR_VAL_A0_ADDR A:0x64384080
y.create.l HWIO_TXC_PP_PHASE_OVR_VAL_A0_ADDR A:0x64384084
y.create.l HWIO_TXC_DP_ENV_OVR_VAL_A0_ADDR A:0x64384088
y.create.l HWIO_TXC_EP_ENV_OVR_VAL_A0_ADDR A:0x6438408c
y.create.l HWIO_TXC_EP_ENV_OVR_VAL_SET2_A0_ADDR A:0x64384090
y.create.l HWIO_TXC_DP_ROT_PHASE_INC_A0_ADDR A:0x643840a0
y.create.l HWIO_TXC_DP_ROT_PHASE_INC_SET2_A0_ADDR A:0x643840a4
y.create.l HWIO_TXC_DP_ROT_PHASE_INIT_A0_ADDR A:0x643840a8
y.create.l HWIO_TXC_DP_ROT_PHASE_INIT_SET2_A0_ADDR A:0x643840ac
y.create.l HWIO_TXC_DP_ROT_PHASE_SHIFT_A0_ADDR A:0x643840b0
y.create.l HWIO_TXC_DP_ROT_PHASE_SHIFT_SET2_A0_ADDR A:0x643840b4
y.create.l HWIO_TXC_DP_IQ_GAIN_A0_ADDR A:0x643840b8
y.create.l HWIO_TXC_DP_IQ_GAIN_SET2_A0_ADDR A:0x643840bc
y.create.l HWIO_TXC_DP_IQMC_A0_ADDR A:0x643840d0
y.create.l HWIO_TXC_DP_IQMC_SET2_A0_ADDR A:0x643840d4
y.create.l HWIO_TXC_DP_PEQ1_A0_ADDR A:0x643840d8
y.create.l HWIO_TXC_DP_PEQ1_SET2_A0_ADDR A:0x643840dc
y.create.l HWIO_TXC_DP_PEQ2_A0_ADDR A:0x643840f0
y.create.l HWIO_TXC_DP_PEQ2_SET2_A0_ADDR A:0x643840f4
y.create.l HWIO_TXC_DP_DCOC_A0_ADDR A:0x643840f8
y.create.l HWIO_TXC_DP_DCOC_SET2_A0_ADDR A:0x643840fc
y.create.l HWIO_TXC_DM1_CFG_A0_ADDR A:0x64384100
y.create.l HWIO_TXC_DP_IQ_GAIN_IMM_A0_ADDR A:0x64384104
y.create.l HWIO_TXC_DP_IQMC_IMM_A0_ADDR A:0x64384108
y.create.l HWIO_TXC_DP_DCOC_IMM_A0_ADDR A:0x6438410c
y.create.l HWIO_TXC_DP_PEQ1_Q_A0_ADDR A:0x64384110
y.create.l HWIO_TXC_DP_PEQ1_Q_SET2_A0_ADDR A:0x64384114
y.create.l HWIO_TXC_EP_GAIN_A0_ADDR A:0x64384160
y.create.l HWIO_TXC_EP_GAIN_SET2_A0_ADDR A:0x64384164
y.create.l HWIO_TXC_EP_PEQ1_A0_ADDR A:0x64384168
y.create.l HWIO_TXC_EP_PEQ1_SET2_A0_ADDR A:0x6438416c
y.create.l HWIO_TXC_EP_DCOC_A0_ADDR A:0x64384170
y.create.l HWIO_TXC_EP_DCOC_SET2_A0_ADDR A:0x64384174
y.create.l HWIO_TXC_EP_DM2_FINE_TAU_A0_ADDR A:0x64384178
y.create.l HWIO_TXC_EP_DM3_FRAC_TAU_A0_ADDR A:0x6438417c
y.create.l HWIO_TXC_PP_GAIN_A0_ADDR A:0x64384180
y.create.l HWIO_TXC_PP_SPILL_A0_ADDR A:0x64384190
y.create.l HWIO_TXC_EP_PEQ2_A0_ADDR A:0x64384198
y.create.l HWIO_TXC_TIMESTAMP_T1_A0_ADDR A:0x643841a0
y.create.l HWIO_TXC_TIMESTAMP_T2_A0_ADDR A:0x643841a8
y.create.l HWIO_TXC_TIMESTAMP_REUSE_A0_ADDR A:0x643841b0
y.create.l HWIO_TXC_SAMPLE_COUNT_A0_ADDR A:0x643841b4
y.create.l HWIO_TXC_SAMPLE_COUNT_CTL_A0_ADDR A:0x643841b8
y.create.l HWIO_TXC_REF_ARM_A0_ADDR A:0x643841c0
y.create.l HWIO_TXC_REF_DWN_FACTOR_A0_ADDR A:0x643841c4
y.create.l HWIO_TXC_REF_NUM_SAMPLES_A0_ADDR A:0x643841c8
y.create.l HWIO_TXC_REF_START_TIME_A0_ADDR A:0x643841cc
y.create.l HWIO_TXC_REF_STATUS_A0_ADDR A:0x643841d0
y.create.l HWIO_TXC_REF_PEAK_POWER_A0_ADDR A:0x643841d4
y.create.l HWIO_TXC_REF_RMS_POWER_M_A0_ADDR A:0x643841d8
y.create.l HWIO_TXC_REF_RMS_POWER_L_A0_ADDR A:0x643841dc
y.create.l HWIO_TXC_REF_MODE_A0_ADDR A:0x643841e0
y.create.l HWIO_TXC_REF_I_GAIN_VAL_A0_ADDR A:0x643841e4
y.create.l HWIO_TXC_REF_Q_GAIN_VAL_A0_ADDR A:0x643841e8
y.create.l HWIO_TXC_REF_POWERCALC_OR_LOG_A0_ADDR A:0x643841ec
y.create.l HWIO_TXC_TESTBUS_SELECT_A0_ADDR A:0x643841f0
y.create.l HWIO_TXC_TEST_BUS_IN_IQ_SWAP_A0_ADDR A:0x643841f4
y.create.l HWIO_TXC_TEST_BUS_OUT_IQ_SWAP_A0_ADDR A:0x643841f8
y.create.l HWIO_TXC_AMAM_PENDING_A0_ADDR A:0x64384220
y.create.l HWIO_TXC_AMPM_PENDING_A0_ADDR A:0x64384224
y.create.l HWIO_TXC_AMAM_PENDING_SET2_A0_ADDR A:0x64384230
y.create.l HWIO_TXC_AMPM_PENDING_SET2_A0_ADDR A:0x64384234
y.create.l HWIO_TXC_AMAM_ACTIVE_A0_ADDR A:0x64384240
y.create.l HWIO_TXC_AMPM_ACTIVE_A0_ADDR A:0x64384244
y.create.l HWIO_TXC_RAMP_ACTIVE_A0_ADDR A:0x6438424c
y.create.l HWIO_TXC_REF_POWER_SUM_I_A0_ADDR A:0x643842e0
y.create.l HWIO_TXC_REF_POWER_SUM_Q_A0_ADDR A:0x643842e4
y.create.l HWIO_TXC_REF_POWER_SUM_IQ_M_A0_ADDR A:0x643842e8
y.create.l HWIO_TXC_REF_POWER_SUM_IQ_L_A0_ADDR A:0x643842ec
y.create.l HWIO_TXC_REF_POWER_SUM_QQ_M_A0_ADDR A:0x643842f0
y.create.l HWIO_TXC_REF_POWER_SUM_QQ_L_A0_ADDR A:0x643842f4
y.create.l HWIO_TXC_DP_CFG_LATCHED_A0_ADDR A:0x64384300
y.create.l HWIO_TXC_DP_ENV_SCALE_VAL_LATCHED_A0_ADDR A:0x64384304
y.create.l HWIO_TXC_DP_PHASE_OVR_VAL_LATCHED_A0_ADDR A:0x64384308
y.create.l HWIO_TXC_PP_PHASE_OVR_VAL_LATCHED_A0_ADDR A:0x6438430c
y.create.l HWIO_TXC_DP_ENV_OVR_VAL_LATCHED_A0_ADDR A:0x64384310
y.create.l HWIO_TXC_EP_ENV_OVR_VAL_LATCHED_A0_ADDR A:0x64384314
y.create.l HWIO_TXC_DP_ROT_PHASE_INC_LATCHED_A0_ADDR A:0x64384318
y.create.l HWIO_TXC_DP_ROT_PHASE_INIT_LATCHED_A0_ADDR A:0x6438431c
y.create.l HWIO_TXC_DP_ROT_PHASE_SHIFT_LATCHED_A0_ADDR A:0x64384320
y.create.l HWIO_TXC_DP_IQ_GAIN_LATCHED_A0_ADDR A:0x64384324
y.create.l HWIO_TXC_DP_IQMC_LATCHED_A0_ADDR A:0x64384328
y.create.l HWIO_TXC_DP_PEQ1_LATCHED_A0_ADDR A:0x6438432c
y.create.l HWIO_TXC_DP_PEQ2_LATCHED_A0_ADDR A:0x64384330
y.create.l HWIO_TXC_DP_DCOC_LATCHED_A0_ADDR A:0x64384334
y.create.l HWIO_TXC_DM1_CFG_LATCHED_A0_ADDR A:0x64384338
y.create.l HWIO_TXC_EP_GAIN_LATCHED_A0_ADDR A:0x6438433c
y.create.l HWIO_TXC_EP_PEQ1_LATCHED_A0_ADDR A:0x64384340
y.create.l HWIO_TXC_EP_DCOC_LATCHED_A0_ADDR A:0x64384344
y.create.l HWIO_TXC_EP_DM2_FINE_TAU_LATCHED_A0_ADDR A:0x64384348
y.create.l HWIO_TXC_EP_DM3_FRAC_TAU_LATCHED_A0_ADDR A:0x6438434c
y.create.l HWIO_TXC_PP_GAIN_LATCHED_A0_ADDR A:0x64384350
y.create.l HWIO_TXC_PP_SPILL_LATCHED_A0_ADDR A:0x64384354
y.create.l HWIO_TXC_EP_PEQ2_LATCHED_A0_ADDR A:0x64384358
y.create.l HWIO_TXC_DP_CFG_2_LATCHED_A0_ADDR A:0x6438435c
y.create.l HWIO_TXC_DP_PEQ1_Q_LATCHED_A0_ADDR A:0x64384360
y.create.l HWIO_TXC_MEM_BANK0_ADDR0_ADDR A:0x64388000
y.create.l HWIO_TXC_MEM_BANK0_ADDR1_ADDR A:0x64388004
y.create.l HWIO_TXC_MEM_BANK0_ADDR2_ADDR A:0x64388008
y.create.l HWIO_TXC_MEM_BANK0_ADDR3_ADDR A:0x6438800c
y.create.l HWIO_TXC_MEM_BANK1_ADDR0_ADDR A:0x64388400
y.create.l HWIO_TXC_MEM_BANK1_ADDR1_ADDR A:0x64388404
y.create.l HWIO_TXC_MEM_BANK1_ADDR2_ADDR A:0x64388408
y.create.l HWIO_TXC_MEM_BANK1_ADDR3_ADDR A:0x6438840c
y.create.l HWIO_TXC_MEM_BANK2_ADDR0_ADDR A:0x64388800
y.create.l HWIO_TXC_MEM_BANK2_ADDR1_ADDR A:0x64388804
y.create.l HWIO_TXC_MEM_BANK2_ADDR2_ADDR A:0x64388808
y.create.l HWIO_TXC_MEM_BANK2_ADDR3_ADDR A:0x6438880c
y.create.l HWIO_TXC_MEM_BANK3_ADDR0_ADDR A:0x64388c00
y.create.l HWIO_TXC_MEM_BANK3_ADDR1_ADDR A:0x64388c04
y.create.l HWIO_TXC_MEM_BANK3_ADDR2_ADDR A:0x64388c08
y.create.l HWIO_TXC_MEM_BANK3_ADDR3_ADDR A:0x64388c0c
y.create.l HWIO_TXC_MEM_BANK4_ADDR0_ADDR A:0x64389000
y.create.l HWIO_TXC_MEM_BANK4_ADDR1_ADDR A:0x64389004
y.create.l HWIO_TXC_MEM_BANK4_ADDR2_ADDR A:0x64389008
y.create.l HWIO_TXC_MEM_BANK4_ADDR3_ADDR A:0x6438900c
y.create.l HWIO_TXC_MEM_BANK5_ADDR0_ADDR A:0x64389400
y.create.l HWIO_TXC_MEM_BANK5_ADDR1_ADDR A:0x64389404
y.create.l HWIO_TXC_MEM_BANK5_ADDR2_ADDR A:0x64389408
y.create.l HWIO_TXC_MEM_BANK5_ADDR3_ADDR A:0x6438940c
y.create.l HWIO_O_TX_TEST_MODE_ADDR A:0x6438a000
y.create.l HWIO_O_TX_CLK_CTL_ADDR A:0x6438a004
y.create.l HWIO_O_TX_SW_CLK_CTL_ADDR A:0x6438a008
y.create.l HWIO_O_TX_CLK_STATUS_REG_ADDR A:0x6438a00c
y.create.l HWIO_O_TX_ENCODER_STATUS_ADDR A:0x6438a010
y.create.l HWIO_O_TX_HW_IDLE_ADDR A:0x6438a014
y.create.l HWIO_O_TX_BUS_TIMEOUT_ADDR A:0x6438a018
y.create.l HWIO_O_TX_WMORE_INT_STATUS_ADDR A:0x6438a01c
y.create.l HWIO_O_TX_WMORE_INT_CLEAR_ADDR A:0x6438a020
y.create.l HWIO_O_TX_WMORE_TX_PWRDWN_ADDR A:0x6438a024
y.create.l HWIO_O_TX_L0_DEC_ACK_BITS_ADDR A:0x6438a028
y.create.l HWIO_O_TX_L1_DEC_ACK_BITS_ADDR A:0x6438a02c
y.create.l HWIO_O_TX_WMORE_CLIP_THR1_ADDR A:0x6438a030
y.create.l HWIO_O_TX_WMORE_CLIP_THR2_ADDR A:0x6438a034
y.create.l HWIO_O_TX_WMORE_TS2_ADDR A:0x6438a038
y.create.l HWIO_O_TX_WMORE_TS1_ADDR A:0x6438a03c
y.create.l HWIO_O_TX_WMORE_CLIP_ENABLE_ADDR A:0x6438a040
y.create.l HWIO_O_TX_WMORE_NOTCH_ENABLE_ADDR A:0x6438a044
y.create.l HWIO_O_TX_WMORE_NOTCH_ALPHA_I_ADDR A:0x6438a048
y.create.l HWIO_O_TX_WMORE_NOTCH_ALPHA_Q_ADDR A:0x6438a04c
y.create.l HWIO_O_TX_WMORE_NOTCH_BETA_ADDR A:0x6438a050
y.create.l HWIO_O_TX_WMORE_NOTCH_TS1_ADDR A:0x6438a054
y.create.l HWIO_O_TX_WMORE_IFFT_SIZE_ADDR A:0x6438a058
y.create.l HWIO_O_TX_WMORE_STATUS_WORD0_ADDR A:0x6438a200
y.create.l HWIO_TX_LTE_WMORE_WORD0_ADDR A:0x6438a300
y.create.l HWIO_TX_LTE_WMORE_WORD1_ADDR A:0x6438a304
y.create.l HWIO_TX_LTE_WMORE_WORD2_ADDR A:0x6438a308
y.create.l HWIO_TX_LTE_WMORE_WORD3_ADDR A:0x6438a30c
y.create.l HWIO_TX_LTE_WMORE_WORD4_ADDR A:0x6438a310
y.create.l HWIO_TX_LTE_WMORE_WORD5_ADDR A:0x6438a314
y.create.l HWIO_TX_LTE_WMORE_WORD6_ADDR A:0x6438a318
y.create.l HWIO_TX_LTE_WMORE_WORD7_ADDR A:0x6438a31c
y.create.l HWIO_TX_LTE_WMORE_UPPTS_WORD0_ADDR A:0x6438a400
y.create.l HWIO_TX_LTE_WMORE_UPPTS_WORD1_ADDR A:0x6438a404
y.create.l HWIO_TX_LTE_WMORE_UPPTS_WORD2_ADDR A:0x6438a408
y.create.l HWIO_TX_LTE_WMORE_UPPTS_WORD3_ADDR A:0x6438a40c
y.create.l HWIO_TX_LTE_WMORE_PRACH_WORD0_ADDR A:0x6438a500
y.create.l HWIO_TX_LTE_WMORE_PRACH_WORD1_ADDR A:0x6438a504
y.create.l HWIO_TX_LTE_WMORE_PRACH_WORD2_ADDR A:0x6438a508
y.create.l HWIO_O_TX_ENC_STATUS_WORD0_ADDR A:0x6438a600
y.create.l HWIO_TX_LTE_PUSCH_ENC_WORD0_ADDR A:0x6438a700
y.create.l HWIO_TX_LTE_PUSCH_ENC_WORD1_ADDR A:0x6438a704
y.create.l HWIO_TX_LTE_PUSCH_ENC_WORD2_ADDR A:0x6438a708
y.create.l HWIO_TX_LTE_PUSCH_ENC_WORD3_ADDR A:0x6438a70c
y.create.l HWIO_TX_LTE_PUSCH_ENC_WORD4_ADDR A:0x6438a710
y.create.l HWIO_O_TX_MOD_STATUS_WORD0_ADDR A:0x6438a800
y.create.l HWIO_TX_LTE_PUSCH_MOD_WORD0_ADDR A:0x6438a900
y.create.l HWIO_TX_LTE_PUSCH_MOD_WORD1_ADDR A:0x6438a904
y.create.l HWIO_TX_LTE_PUSCH_MOD_WORD2_ADDR A:0x6438a908
y.create.l HWIO_TX_LTE_PUSCH_MOD_WORD3_ADDR A:0x6438a90c
y.create.l HWIO_TX_LTE_PUSCH_MOD_WORD4_ADDR A:0x6438a910
y.create.l HWIO_TX_LTE_PUSCH_MOD_WORD5_ADDR A:0x6438a914
y.create.l HWIO_TX_LTE_PUSCH_MOD_WORD6_ADDR A:0x6438a918
y.create.l HWIO_TX_LTE_PUSCH_MOD_WORD7_ADDR A:0x6438a91c
y.create.l HWIO_TX_LTE_PUSCH_MOD_WORD8_ADDR A:0x6438a920
y.create.l HWIO_TX_LTE_PUSCH_MOD_WORD9_ADDR A:0x6438a924
y.create.l HWIO_TX_LTE_PUSCH_MOD_WORD10_ADDR A:0x6438a928
y.create.l HWIO_TX_LTE_PUSCH_MOD_WORD11_ADDR A:0x6438a92c
y.create.l HWIO_TX_LTE_PUSCH_MOD_WORD12_ADDR A:0x6438a930
y.create.l HWIO_TX_LTE_PUSCH_MOD_WORD13_ADDR A:0x6438a934
y.create.l HWIO_TX_LTE_PUSCH_MOD_WORD14_ADDR A:0x6438a938
y.create.l HWIO_TX_LTE_PUSCH_MOD_WORD15_ADDR A:0x6438a93c
y.create.l HWIO_TX_LTE_PUSCH_MOD_WORD16_ADDR A:0x6438a940
y.create.l HWIO_TX_LTE_PUSCH_MOD_WORD17_ADDR A:0x6438a944
y.create.l HWIO_TX_LTE_PUSCH_MOD_WORD18_ADDR A:0x6438a948
y.create.l HWIO_TX_LTE_PUSCH_MOD_WORD19_ADDR A:0x6438a94c
y.create.l HWIO_TX_LTE_PUSCH_MOD_WORD20_ADDR A:0x6438a950
y.create.l HWIO_TX_LTE_PUSCH_MOD_WORD21_ADDR A:0x6438a954
y.create.l HWIO_TX_LTE_PUCCH_MOD_WORD0_ADDR A:0x6438aa00
y.create.l HWIO_TX_LTE_PUCCH_MOD_WORD1_ADDR A:0x6438aa04
y.create.l HWIO_TX_LTE_PUCCH_MOD_WORD2_ADDR A:0x6438aa08
y.create.l HWIO_TX_LTE_PUCCH_MOD_WORD3_ADDR A:0x6438aa0c
y.create.l HWIO_TX_LTE_PUCCH_MOD_WORD4_ADDR A:0x6438aa10
y.create.l HWIO_TX_LTE_PUCCH_MOD_WORD5_ADDR A:0x6438aa14
y.create.l HWIO_TX_LTE_PUCCH_MOD_WORD6_ADDR A:0x6438aa18
y.create.l HWIO_TX_LTE_PUCCH_MOD_WORD7_ADDR A:0x6438aa1c
y.create.l HWIO_TX_LTE_PUCCH_MOD_WORD8_ADDR A:0x6438aa20
y.create.l HWIO_TX_LTE_PUCCH_MOD_WORD9_ADDR A:0x6438aa24
y.create.l HWIO_TX_LTE_PUCCH_MOD_WORD10_ADDR A:0x6438aa28
y.create.l HWIO_TX_LTE_PUCCH_MOD_WORD11_ADDR A:0x6438aa2c
y.create.l HWIO_TX_LTE_PUCCH_MOD_WORD12_ADDR A:0x6438aa30
y.create.l HWIO_TX_LTE_PUCCH_MOD_WORD13_ADDR A:0x6438aa34
y.create.l HWIO_TX_LTE_PRACH_MOD_WORD0_ADDR A:0x6438ab00
y.create.l HWIO_TX_LTE_PRACH_MOD_WORD1_ADDR A:0x6438ab04
y.create.l HWIO_TX_LTE_PRACH_MOD_WORD2_ADDR A:0x6438ab08
y.create.l HWIO_TX_LTE_PRACH_MOD_WORD3_ADDR A:0x6438ab0c
y.create.l HWIO_TX_LTE_PRACH_MOD_WORD4_ADDR A:0x6438ab10
y.create.l HWIO_TX_LTE_PRACH_MOD_WORD5_ADDR A:0x6438ab14
y.create.l HWIO_TX_LTE_UPPTS_MOD_WORD0_ADDR A:0x6438ac00
y.create.l HWIO_TX_LTE_UPPTS_MOD_WORD1_ADDR A:0x6438ac04
y.create.l HWIO_TX_LTE_UPPTS_MOD_WORD2_ADDR A:0x6438ac08
y.create.l HWIO_TX_LTE_UPPTS_MOD_WORD3_ADDR A:0x6438ac0c
y.create.l HWIO_TX_LTE_UPPTS_MOD_WORD4_ADDR A:0x6438ac10
y.create.l HWIO_TX_LTE_UPPTS_MOD_WORD5_ADDR A:0x6438ac14
y.create.l HWIO_TX_LTE_UPPTS_MOD_WORD6_ADDR A:0x6438ac18
y.create.l HWIO_TX_LTE_UPPTS_MOD_WORD7_ADDR A:0x6438ac1c
y.create.l HWIO_TX_LTE_UPPTS_MOD_WORD8_ADDR A:0x6438ac20
y.create.l HWIO_TX_LTE_UPPTS_MOD_WORD9_ADDR A:0x6438ac24
y.create.l HWIO_TX_LTE_PUSCH_MOD_ACK_WORD0_ADDR A:0x6438ad00
y.create.l HWIO_TX_LTE_PUCCH_MOD_ACK_WORD0_ADDR A:0x6438ae00
y.create.l HWIO_RXFE_ENABLE_ADDR A:0x64360000
y.create.l HWIO_RXFE_ADC0_LOGIC_CFG_ADDR A:0x64360004
y.create.l HWIO_RXFE_ADC1_LOGIC_CFG_ADDR A:0x64360008
y.create.l HWIO_RXFE_ADC2_LOGIC_CFG_ADDR A:0x6436000c
y.create.l HWIO_RXFE_ADC3_LOGIC_CFG_ADDR A:0x64360010
y.create.l HWIO_RXFE_WB0_ADCMUX_CFG_ADDR A:0x64360018
y.create.l HWIO_RXFE_WB1_ADCMUX_CFG_ADDR A:0x6436001c
y.create.l HWIO_RXFE_WB2_ADCMUX_CFG_ADDR A:0x64360020
y.create.l HWIO_RXFE_WB3_ADCMUX_CFG_ADDR A:0x64360024
y.create.l HWIO_RXFE_NB0_WBMUX_CFG_ADDR A:0x6436002c
y.create.l HWIO_RXFE_NB1_WBMUX_CFG_ADDR A:0x64360030
y.create.l HWIO_RXFE_NB2_WBMUX_CFG_ADDR A:0x64360034
y.create.l HWIO_RXFE_NB3_WBMUX_CFG_ADDR A:0x64360038
y.create.l HWIO_RXFE_NB4_WBMUX_CFG_ADDR A:0x6436003c
y.create.l HWIO_RXFE_NB5_WBMUX_CFG_ADDR A:0x64360040
y.create.l HWIO_RXFE_TOP_STATUS_ADDR A:0x6436004c
y.create.l HWIO_RXFE_RFIF_UPDATE_CMD_ADDR A:0x64360050
y.create.l HWIO_RXFE_CMNNOTCH_FILT0_CFG0_ADDR A:0x64360054
y.create.l HWIO_RXFE_CMNNOTCH_FILT0_CFG1_ADDR A:0x64360058
y.create.l HWIO_RXFE_CMNNOTCH_FILT1_CFG0_ADDR A:0x6436005c
y.create.l HWIO_RXFE_CMNNOTCH_FILT1_CFG1_ADDR A:0x64360060
y.create.l HWIO_RXFE_CMNNOTCH_FILT2_CFG0_ADDR A:0x64360064
y.create.l HWIO_RXFE_CMNNOTCH_FILT2_CFG1_ADDR A:0x64360068
y.create.l HWIO_RXFE_CMNNOTCH_FILT3_CFG0_ADDR A:0x6436006c
y.create.l HWIO_RXFE_CMNNOTCH_FILT3_CFG1_ADDR A:0x64360070
y.create.l HWIO_RXFE_CMNNOTCH_FILT01_CFG_ADDR A:0x64360074
y.create.l HWIO_RXFE_CMNNOTCH_FILT23_CFG_ADDR A:0x64360078
y.create.l HWIO_RXFE_ACI_FILT0_CFG_ADDR A:0x6436007c
y.create.l HWIO_RXFE_ACI_FILT1_CFG_ADDR A:0x64360080
y.create.l HWIO_RXFE_TOP_SPARE_REG_ADDR A:0x64360084
y.create.l HWIO_RXFE_DBG_ENABLES_ADDR A:0x64360090
y.create.l HWIO_RXFE_DBG_PROBE_CTL_ADDR A:0x64360094
y.create.l HWIO_RXFE_DBG_CMD_ADDR A:0x64360098
y.create.l HWIO_RXFE_PBS_CFG_ADDR A:0x6436009c
y.create.l HWIO_RXFE_ADC_TEST1_REG_ADC0_ADDR A:0x64362000
y.create.l HWIO_RXFE_ADC_TEST2_REG_ADC0_ADDR A:0x64362004
y.create.l HWIO_RXFE_ADC_TEST3_REG_ADC0_ADDR A:0x64362008
y.create.l HWIO_RXFE_ADC_CONFIG1_REG_ADC0_ADDR A:0x6436200c
y.create.l HWIO_RXFE_ADC_CONFIG2_REG_ADC0_ADDR A:0x64362010
y.create.l HWIO_RXFE_ADC_CONTROL_REG_ADC0_ADDR A:0x64362014
y.create.l HWIO_RXFE_ADC_TEST1_REG_ADC1_ADDR A:0x64362100
y.create.l HWIO_RXFE_ADC_TEST2_REG_ADC1_ADDR A:0x64362104
y.create.l HWIO_RXFE_ADC_TEST3_REG_ADC1_ADDR A:0x64362108
y.create.l HWIO_RXFE_ADC_CONFIG1_REG_ADC1_ADDR A:0x6436210c
y.create.l HWIO_RXFE_ADC_CONFIG2_REG_ADC1_ADDR A:0x64362110
y.create.l HWIO_RXFE_ADC_CONTROL_REG_ADC1_ADDR A:0x64362114
y.create.l HWIO_RXFE_ADC_TEST1_REG_ADC2_ADDR A:0x64362200
y.create.l HWIO_RXFE_ADC_TEST2_REG_ADC2_ADDR A:0x64362204
y.create.l HWIO_RXFE_ADC_TEST3_REG_ADC2_ADDR A:0x64362208
y.create.l HWIO_RXFE_ADC_CONFIG1_REG_ADC2_ADDR A:0x6436220c
y.create.l HWIO_RXFE_ADC_CONFIG2_REG_ADC2_ADDR A:0x64362210
y.create.l HWIO_RXFE_ADC_CONTROL_REG_ADC2_ADDR A:0x64362214
y.create.l HWIO_RXFE_ADC_TEST1_REG_ADC3_ADDR A:0x64362300
y.create.l HWIO_RXFE_ADC_TEST2_REG_ADC3_ADDR A:0x64362304
y.create.l HWIO_RXFE_ADC_TEST3_REG_ADC3_ADDR A:0x64362308
y.create.l HWIO_RXFE_ADC_CONFIG1_REG_ADC3_ADDR A:0x6436230c
y.create.l HWIO_RXFE_ADC_CONFIG2_REG_ADC3_ADDR A:0x64362310
y.create.l HWIO_RXFE_ADC_CONTROL_REG_ADC3_ADDR A:0x64362314
y.create.l HWIO_RXFE_WB_TOP_CTL_WB0_ADDR A:0x64364000
y.create.l HWIO_RXFE_WB_TOP_CMD_WB0_ADDR A:0x64364004
y.create.l HWIO_RXFE_WB_TOP_STATUS_WB0_ADDR A:0x64364008
y.create.l HWIO_RXFE_WB_STOPGATE_ACTION_SAMPLE_WB0_ADDR A:0x6436400c
y.create.l HWIO_RXFE_WB_TIMINGCTL_STATUS_WB0_ADDR A:0x64364010
y.create.l HWIO_RXFE_WB_MISC_CFG_WB0_ADDR A:0x64364014
y.create.l HWIO_RXFE_WB_WBPWR_CFG_WB0_ADDR A:0x64364018
y.create.l HWIO_RXFE_WB_WBPWR_CMD_WB0_ADDR A:0x6436401c
y.create.l HWIO_RXFE_WB_WBPWR_START_ACTION_SAMPLE_WB0_ADDR A:0x64364020
y.create.l HWIO_RXFE_WB_WBPWR_START_MASK_WB0_ADDR A:0x64364024
y.create.l HWIO_RXFE_WB_WBPWR_STOP_ACTION_SAMPLE_WB0_ADDR A:0x64364028
y.create.l HWIO_RXFE_WB_WBPWR_FINAL_ACC_WB0_ADDR A:0x6436402c
y.create.l HWIO_RXFE_WB_WBPWR_CURR_ACC_WB0_ADDR A:0x64364030
y.create.l HWIO_RXFE_WB_WBPWR_MAX_ACC_WB0_ADDR A:0x64364034
y.create.l HWIO_RXFE_WB_WBDC_CFG_WB0_ADDR A:0x64364038
y.create.l HWIO_RXFE_WB_WBDC_CMD_WB0_ADDR A:0x6436403c
y.create.l HWIO_RXFE_WB_WBDC_START_ACTION_SAMPLE_WB0_ADDR A:0x64364040
y.create.l HWIO_RXFE_WB_WBDC_STOP_ACTION_SAMPLE_WB0_ADDR A:0x64364044
y.create.l HWIO_RXFE_WB_WBDC_UPDATE_ACTION_SAMPLE_WB0_ADDR A:0x64364048
y.create.l HWIO_RXFE_WB_WBDC_UPDATE_DELAY_WB0_ADDR A:0x6436404c
y.create.l HWIO_RXFE_WB_WBDC_OVRD_I_WB0_ADDR A:0x64364050
y.create.l HWIO_RXFE_WB_WBDC_OVRD_Q_WB0_ADDR A:0x64364054
y.create.l HWIO_RXFE_WB_WBDC_EST1_CURR_I_WB0_ADDR A:0x64364058
y.create.l HWIO_RXFE_WB_WBDC_EST1_CURR_Q_WB0_ADDR A:0x6436405c
y.create.l HWIO_RXFE_WB_WBDC_EST1_PREV_I_WB0_ADDR A:0x64364060
y.create.l HWIO_RXFE_WB_WBDC_EST1_PREV_Q_WB0_ADDR A:0x64364064
y.create.l HWIO_RXFE_WB_WBDC_EST1_LOAD_I_WB0_ADDR A:0x64364068
y.create.l HWIO_RXFE_WB_WBDC_EST1_LOAD_Q_WB0_ADDR A:0x6436406c
y.create.l HWIO_RXFE_WB_WBDC_EST2_CURR_I_WB0_ADDR A:0x64364070
y.create.l HWIO_RXFE_WB_WBDC_EST2_CURR_Q_WB0_ADDR A:0x64364074
y.create.l HWIO_RXFE_WB_WBDC_EST2_PREV_I_WB0_ADDR A:0x64364078
y.create.l HWIO_RXFE_WB_WBDC_EST2_PREV_Q_WB0_ADDR A:0x6436407c
y.create.l HWIO_RXFE_WB_WBDC_EST2_LOAD_I_WB0_ADDR A:0x64364080
y.create.l HWIO_RXFE_WB_WBDC_EST2_LOAD_Q_WB0_ADDR A:0x64364084
y.create.l HWIO_RXFE_WB_VSRC_CFG_WB0_ADDR A:0x64364088
y.create.l HWIO_RXFE_WB_VSRC_T2BYT1M1_WB0_ADDR A:0x6436408c
y.create.l HWIO_RXFE_WB_VSRC_CMD_WB0_ADDR A:0x64364090
y.create.l HWIO_RXFE_WB_VSRC_STATUS_WB0_ADDR A:0x64364094
y.create.l HWIO_RXFE_WB_VSRC_UPDT_ACTION_SAMPLE_WB0_ADDR A:0x64364098
y.create.l HWIO_RXFE_WB_VSRC_CURR_T1BYT2_WB0_ADDR A:0x6436409c
y.create.l HWIO_RXFE_WB_VSRC_CURR_T2BYT1M1_WB0_ADDR A:0x643640a0
y.create.l HWIO_RXFE_WB_VSRC_SCTR_LOAD_VALUE_WB0_ADDR A:0x643640a4
y.create.l HWIO_RXFE_WB_VSRC_SCTR_WA_WB0_ADDR A:0x643640a8
y.create.l HWIO_RXFE_WB_VSRC_SCTR_SNAPSHOT_WB0_ADDR A:0x643640ac
y.create.l HWIO_RXFE_WB_VSRC_ACC_SNAPSHOT_WB0_ADDR A:0x643640b0
y.create.l HWIO_RXFE_WB_DEC_FILT_CFG_WB0_ADDR A:0x643640b4
y.create.l HWIO_RXFE_WB_IQMC_CFG0_WB0_ADDR A:0x643640b8
y.create.l HWIO_RXFE_WB_IQMC_CFG1_WB0_ADDR A:0x643640bc
y.create.l HWIO_RXFE_WB_IQMC_CURR_VALS_WB0_ADDR A:0x643640c0
y.create.l HWIO_RXFE_WB_IQMC_UPDT_CMD_WB0_ADDR A:0x643640c4
y.create.l HWIO_RXFE_WB_IQMC_UPDT_ACTION_SAMPLE_WB0_ADDR A:0x643640c8
y.create.l HWIO_RXFE_WB_NOTCH_FILT0_CFG0_WB0_ADDR A:0x643640cc
y.create.l HWIO_RXFE_WB_NOTCH_FILT1_CFG0_WB0_ADDR A:0x643640d4
y.create.l HWIO_RXFE_WB_NOTCH_FILT2_CFG0_WB0_ADDR A:0x643640dc
y.create.l HWIO_RXFE_WB_NOTCH_FILT0_CFG1_WB0_ADDR A:0x643640d0
y.create.l HWIO_RXFE_WB_NOTCH_FILT1_CFG1_WB0_ADDR A:0x643640d8
y.create.l HWIO_RXFE_WB_NOTCH_FILT2_CFG1_WB0_ADDR A:0x643640e0
y.create.l HWIO_RXFE_WB_NOTCH_FILT012_CFG_WB0_ADDR A:0x643640e4
y.create.l HWIO_RXFE_WB_SPARE_REG_WB0_ADDR A:0x643640e8
y.create.l HWIO_RXFE_WB_TOP_CTL_WB1_ADDR A:0x64365000
y.create.l HWIO_RXFE_WB_TOP_CMD_WB1_ADDR A:0x64365004
y.create.l HWIO_RXFE_WB_TOP_STATUS_WB1_ADDR A:0x64365008
y.create.l HWIO_RXFE_WB_STOPGATE_ACTION_SAMPLE_WB1_ADDR A:0x6436500c
y.create.l HWIO_RXFE_WB_TIMINGCTL_STATUS_WB1_ADDR A:0x64365010
y.create.l HWIO_RXFE_WB_MISC_CFG_WB1_ADDR A:0x64365014
y.create.l HWIO_RXFE_WB_WBPWR_CFG_WB1_ADDR A:0x64365018
y.create.l HWIO_RXFE_WB_WBPWR_CMD_WB1_ADDR A:0x6436501c
y.create.l HWIO_RXFE_WB_WBPWR_START_ACTION_SAMPLE_WB1_ADDR A:0x64365020
y.create.l HWIO_RXFE_WB_WBPWR_START_MASK_WB1_ADDR A:0x64365024
y.create.l HWIO_RXFE_WB_WBPWR_STOP_ACTION_SAMPLE_WB1_ADDR A:0x64365028
y.create.l HWIO_RXFE_WB_WBPWR_FINAL_ACC_WB1_ADDR A:0x6436502c
y.create.l HWIO_RXFE_WB_WBPWR_CURR_ACC_WB1_ADDR A:0x64365030
y.create.l HWIO_RXFE_WB_WBPWR_MAX_ACC_WB1_ADDR A:0x64365034
y.create.l HWIO_RXFE_WB_WBDC_CFG_WB1_ADDR A:0x64365038
y.create.l HWIO_RXFE_WB_WBDC_CMD_WB1_ADDR A:0x6436503c
y.create.l HWIO_RXFE_WB_WBDC_START_ACTION_SAMPLE_WB1_ADDR A:0x64365040
y.create.l HWIO_RXFE_WB_WBDC_STOP_ACTION_SAMPLE_WB1_ADDR A:0x64365044
y.create.l HWIO_RXFE_WB_WBDC_UPDATE_ACTION_SAMPLE_WB1_ADDR A:0x64365048
y.create.l HWIO_RXFE_WB_WBDC_UPDATE_DELAY_WB1_ADDR A:0x6436504c
y.create.l HWIO_RXFE_WB_WBDC_OVRD_I_WB1_ADDR A:0x64365050
y.create.l HWIO_RXFE_WB_WBDC_OVRD_Q_WB1_ADDR A:0x64365054
y.create.l HWIO_RXFE_WB_WBDC_EST1_CURR_I_WB1_ADDR A:0x64365058
y.create.l HWIO_RXFE_WB_WBDC_EST1_CURR_Q_WB1_ADDR A:0x6436505c
y.create.l HWIO_RXFE_WB_WBDC_EST1_PREV_I_WB1_ADDR A:0x64365060
y.create.l HWIO_RXFE_WB_WBDC_EST1_PREV_Q_WB1_ADDR A:0x64365064
y.create.l HWIO_RXFE_WB_WBDC_EST1_LOAD_I_WB1_ADDR A:0x64365068
y.create.l HWIO_RXFE_WB_WBDC_EST1_LOAD_Q_WB1_ADDR A:0x6436506c
y.create.l HWIO_RXFE_WB_WBDC_EST2_CURR_I_WB1_ADDR A:0x64365070
y.create.l HWIO_RXFE_WB_WBDC_EST2_CURR_Q_WB1_ADDR A:0x64365074
y.create.l HWIO_RXFE_WB_WBDC_EST2_PREV_I_WB1_ADDR A:0x64365078
y.create.l HWIO_RXFE_WB_WBDC_EST2_PREV_Q_WB1_ADDR A:0x6436507c
y.create.l HWIO_RXFE_WB_WBDC_EST2_LOAD_I_WB1_ADDR A:0x64365080
y.create.l HWIO_RXFE_WB_WBDC_EST2_LOAD_Q_WB1_ADDR A:0x64365084
y.create.l HWIO_RXFE_WB_VSRC_CFG_WB1_ADDR A:0x64365088
y.create.l HWIO_RXFE_WB_VSRC_T2BYT1M1_WB1_ADDR A:0x6436508c
y.create.l HWIO_RXFE_WB_VSRC_CMD_WB1_ADDR A:0x64365090
y.create.l HWIO_RXFE_WB_VSRC_STATUS_WB1_ADDR A:0x64365094
y.create.l HWIO_RXFE_WB_VSRC_UPDT_ACTION_SAMPLE_WB1_ADDR A:0x64365098
y.create.l HWIO_RXFE_WB_VSRC_CURR_T1BYT2_WB1_ADDR A:0x6436509c
y.create.l HWIO_RXFE_WB_VSRC_CURR_T2BYT1M1_WB1_ADDR A:0x643650a0
y.create.l HWIO_RXFE_WB_VSRC_SCTR_LOAD_VALUE_WB1_ADDR A:0x643650a4
y.create.l HWIO_RXFE_WB_VSRC_SCTR_WA_WB1_ADDR A:0x643650a8
y.create.l HWIO_RXFE_WB_VSRC_SCTR_SNAPSHOT_WB1_ADDR A:0x643650ac
y.create.l HWIO_RXFE_WB_VSRC_ACC_SNAPSHOT_WB1_ADDR A:0x643650b0
y.create.l HWIO_RXFE_WB_DEC_FILT_CFG_WB1_ADDR A:0x643650b4
y.create.l HWIO_RXFE_WB_IQMC_CFG0_WB1_ADDR A:0x643650b8
y.create.l HWIO_RXFE_WB_IQMC_CFG1_WB1_ADDR A:0x643650bc
y.create.l HWIO_RXFE_WB_IQMC_CURR_VALS_WB1_ADDR A:0x643650c0
y.create.l HWIO_RXFE_WB_IQMC_UPDT_CMD_WB1_ADDR A:0x643650c4
y.create.l HWIO_RXFE_WB_IQMC_UPDT_ACTION_SAMPLE_WB1_ADDR A:0x643650c8
y.create.l HWIO_RXFE_WB_NOTCH_FILT0_CFG0_WB1_ADDR A:0x643650cc
y.create.l HWIO_RXFE_WB_NOTCH_FILT1_CFG0_WB1_ADDR A:0x643650d4
y.create.l HWIO_RXFE_WB_NOTCH_FILT2_CFG0_WB1_ADDR A:0x643650dc
y.create.l HWIO_RXFE_WB_NOTCH_FILT0_CFG1_WB1_ADDR A:0x643650d0
y.create.l HWIO_RXFE_WB_NOTCH_FILT1_CFG1_WB1_ADDR A:0x643650d8
y.create.l HWIO_RXFE_WB_NOTCH_FILT2_CFG1_WB1_ADDR A:0x643650e0
y.create.l HWIO_RXFE_WB_NOTCH_FILT012_CFG_WB1_ADDR A:0x643650e4
y.create.l HWIO_RXFE_WB_SPARE_REG_WB1_ADDR A:0x643650e8
y.create.l HWIO_RXFE_WB_TOP_CTL_WB2_ADDR A:0x64366000
y.create.l HWIO_RXFE_WB_TOP_CMD_WB2_ADDR A:0x64366004
y.create.l HWIO_RXFE_WB_TOP_STATUS_WB2_ADDR A:0x64366008
y.create.l HWIO_RXFE_WB_STOPGATE_ACTION_SAMPLE_WB2_ADDR A:0x6436600c
y.create.l HWIO_RXFE_WB_TIMINGCTL_STATUS_WB2_ADDR A:0x64366010
y.create.l HWIO_RXFE_WB_MISC_CFG_WB2_ADDR A:0x64366014
y.create.l HWIO_RXFE_WB_WBPWR_CFG_WB2_ADDR A:0x64366018
y.create.l HWIO_RXFE_WB_WBPWR_CMD_WB2_ADDR A:0x6436601c
y.create.l HWIO_RXFE_WB_WBPWR_START_ACTION_SAMPLE_WB2_ADDR A:0x64366020
y.create.l HWIO_RXFE_WB_WBPWR_START_MASK_WB2_ADDR A:0x64366024
y.create.l HWIO_RXFE_WB_WBPWR_STOP_ACTION_SAMPLE_WB2_ADDR A:0x64366028
y.create.l HWIO_RXFE_WB_WBPWR_FINAL_ACC_WB2_ADDR A:0x6436602c
y.create.l HWIO_RXFE_WB_WBPWR_CURR_ACC_WB2_ADDR A:0x64366030
y.create.l HWIO_RXFE_WB_WBPWR_MAX_ACC_WB2_ADDR A:0x64366034
y.create.l HWIO_RXFE_WB_WBDC_CFG_WB2_ADDR A:0x64366038
y.create.l HWIO_RXFE_WB_WBDC_CMD_WB2_ADDR A:0x6436603c
y.create.l HWIO_RXFE_WB_WBDC_START_ACTION_SAMPLE_WB2_ADDR A:0x64366040
y.create.l HWIO_RXFE_WB_WBDC_STOP_ACTION_SAMPLE_WB2_ADDR A:0x64366044
y.create.l HWIO_RXFE_WB_WBDC_UPDATE_ACTION_SAMPLE_WB2_ADDR A:0x64366048
y.create.l HWIO_RXFE_WB_WBDC_UPDATE_DELAY_WB2_ADDR A:0x6436604c
y.create.l HWIO_RXFE_WB_WBDC_OVRD_I_WB2_ADDR A:0x64366050
y.create.l HWIO_RXFE_WB_WBDC_OVRD_Q_WB2_ADDR A:0x64366054
y.create.l HWIO_RXFE_WB_WBDC_EST1_CURR_I_WB2_ADDR A:0x64366058
y.create.l HWIO_RXFE_WB_WBDC_EST1_CURR_Q_WB2_ADDR A:0x6436605c
y.create.l HWIO_RXFE_WB_WBDC_EST1_PREV_I_WB2_ADDR A:0x64366060
y.create.l HWIO_RXFE_WB_WBDC_EST1_PREV_Q_WB2_ADDR A:0x64366064
y.create.l HWIO_RXFE_WB_WBDC_EST1_LOAD_I_WB2_ADDR A:0x64366068
y.create.l HWIO_RXFE_WB_WBDC_EST1_LOAD_Q_WB2_ADDR A:0x6436606c
y.create.l HWIO_RXFE_WB_WBDC_EST2_CURR_I_WB2_ADDR A:0x64366070
y.create.l HWIO_RXFE_WB_WBDC_EST2_CURR_Q_WB2_ADDR A:0x64366074
y.create.l HWIO_RXFE_WB_WBDC_EST2_PREV_I_WB2_ADDR A:0x64366078
y.create.l HWIO_RXFE_WB_WBDC_EST2_PREV_Q_WB2_ADDR A:0x6436607c
y.create.l HWIO_RXFE_WB_WBDC_EST2_LOAD_I_WB2_ADDR A:0x64366080
y.create.l HWIO_RXFE_WB_WBDC_EST2_LOAD_Q_WB2_ADDR A:0x64366084
y.create.l HWIO_RXFE_WB_VSRC_CFG_WB2_ADDR A:0x64366088
y.create.l HWIO_RXFE_WB_VSRC_T2BYT1M1_WB2_ADDR A:0x6436608c
y.create.l HWIO_RXFE_WB_VSRC_CMD_WB2_ADDR A:0x64366090
y.create.l HWIO_RXFE_WB_VSRC_STATUS_WB2_ADDR A:0x64366094
y.create.l HWIO_RXFE_WB_VSRC_UPDT_ACTION_SAMPLE_WB2_ADDR A:0x64366098
y.create.l HWIO_RXFE_WB_VSRC_CURR_T1BYT2_WB2_ADDR A:0x6436609c
y.create.l HWIO_RXFE_WB_VSRC_CURR_T2BYT1M1_WB2_ADDR A:0x643660a0
y.create.l HWIO_RXFE_WB_VSRC_SCTR_LOAD_VALUE_WB2_ADDR A:0x643660a4
y.create.l HWIO_RXFE_WB_VSRC_SCTR_WA_WB2_ADDR A:0x643660a8
y.create.l HWIO_RXFE_WB_VSRC_SCTR_SNAPSHOT_WB2_ADDR A:0x643660ac
y.create.l HWIO_RXFE_WB_VSRC_ACC_SNAPSHOT_WB2_ADDR A:0x643660b0
y.create.l HWIO_RXFE_WB_DEC_FILT_CFG_WB2_ADDR A:0x643660b4
y.create.l HWIO_RXFE_WB_IQMC_CFG0_WB2_ADDR A:0x643660b8
y.create.l HWIO_RXFE_WB_IQMC_CFG1_WB2_ADDR A:0x643660bc
y.create.l HWIO_RXFE_WB_IQMC_CURR_VALS_WB2_ADDR A:0x643660c0
y.create.l HWIO_RXFE_WB_IQMC_UPDT_CMD_WB2_ADDR A:0x643660c4
y.create.l HWIO_RXFE_WB_IQMC_UPDT_ACTION_SAMPLE_WB2_ADDR A:0x643660c8
y.create.l HWIO_RXFE_WB_NOTCH_FILT0_CFG0_WB2_ADDR A:0x643660cc
y.create.l HWIO_RXFE_WB_NOTCH_FILT1_CFG0_WB2_ADDR A:0x643660d4
y.create.l HWIO_RXFE_WB_NOTCH_FILT2_CFG0_WB2_ADDR A:0x643660dc
y.create.l HWIO_RXFE_WB_NOTCH_FILT0_CFG1_WB2_ADDR A:0x643660d0
y.create.l HWIO_RXFE_WB_NOTCH_FILT1_CFG1_WB2_ADDR A:0x643660d8
y.create.l HWIO_RXFE_WB_NOTCH_FILT2_CFG1_WB2_ADDR A:0x643660e0
y.create.l HWIO_RXFE_WB_NOTCH_FILT012_CFG_WB2_ADDR A:0x643660e4
y.create.l HWIO_RXFE_WB_SPARE_REG_WB2_ADDR A:0x643660e8
y.create.l HWIO_RXFE_WB_TOP_CTL_WB3_ADDR A:0x64367000
y.create.l HWIO_RXFE_WB_TOP_CMD_WB3_ADDR A:0x64367004
y.create.l HWIO_RXFE_WB_TOP_STATUS_WB3_ADDR A:0x64367008
y.create.l HWIO_RXFE_WB_STOPGATE_ACTION_SAMPLE_WB3_ADDR A:0x6436700c
y.create.l HWIO_RXFE_WB_TIMINGCTL_STATUS_WB3_ADDR A:0x64367010
y.create.l HWIO_RXFE_WB_MISC_CFG_WB3_ADDR A:0x64367014
y.create.l HWIO_RXFE_WB_WBPWR_CFG_WB3_ADDR A:0x64367018
y.create.l HWIO_RXFE_WB_WBPWR_CMD_WB3_ADDR A:0x6436701c
y.create.l HWIO_RXFE_WB_WBPWR_START_ACTION_SAMPLE_WB3_ADDR A:0x64367020
y.create.l HWIO_RXFE_WB_WBPWR_START_MASK_WB3_ADDR A:0x64367024
y.create.l HWIO_RXFE_WB_WBPWR_STOP_ACTION_SAMPLE_WB3_ADDR A:0x64367028
y.create.l HWIO_RXFE_WB_WBPWR_FINAL_ACC_WB3_ADDR A:0x6436702c
y.create.l HWIO_RXFE_WB_WBPWR_CURR_ACC_WB3_ADDR A:0x64367030
y.create.l HWIO_RXFE_WB_WBPWR_MAX_ACC_WB3_ADDR A:0x64367034
y.create.l HWIO_RXFE_WB_WBDC_CFG_WB3_ADDR A:0x64367038
y.create.l HWIO_RXFE_WB_WBDC_CMD_WB3_ADDR A:0x6436703c
y.create.l HWIO_RXFE_WB_WBDC_START_ACTION_SAMPLE_WB3_ADDR A:0x64367040
y.create.l HWIO_RXFE_WB_WBDC_STOP_ACTION_SAMPLE_WB3_ADDR A:0x64367044
y.create.l HWIO_RXFE_WB_WBDC_UPDATE_ACTION_SAMPLE_WB3_ADDR A:0x64367048
y.create.l HWIO_RXFE_WB_WBDC_UPDATE_DELAY_WB3_ADDR A:0x6436704c
y.create.l HWIO_RXFE_WB_WBDC_OVRD_I_WB3_ADDR A:0x64367050
y.create.l HWIO_RXFE_WB_WBDC_OVRD_Q_WB3_ADDR A:0x64367054
y.create.l HWIO_RXFE_WB_WBDC_EST1_CURR_I_WB3_ADDR A:0x64367058
y.create.l HWIO_RXFE_WB_WBDC_EST1_CURR_Q_WB3_ADDR A:0x6436705c
y.create.l HWIO_RXFE_WB_WBDC_EST1_PREV_I_WB3_ADDR A:0x64367060
y.create.l HWIO_RXFE_WB_WBDC_EST1_PREV_Q_WB3_ADDR A:0x64367064
y.create.l HWIO_RXFE_WB_WBDC_EST1_LOAD_I_WB3_ADDR A:0x64367068
y.create.l HWIO_RXFE_WB_WBDC_EST1_LOAD_Q_WB3_ADDR A:0x6436706c
y.create.l HWIO_RXFE_WB_WBDC_EST2_CURR_I_WB3_ADDR A:0x64367070
y.create.l HWIO_RXFE_WB_WBDC_EST2_CURR_Q_WB3_ADDR A:0x64367074
y.create.l HWIO_RXFE_WB_WBDC_EST2_PREV_I_WB3_ADDR A:0x64367078
y.create.l HWIO_RXFE_WB_WBDC_EST2_PREV_Q_WB3_ADDR A:0x6436707c
y.create.l HWIO_RXFE_WB_WBDC_EST2_LOAD_I_WB3_ADDR A:0x64367080
y.create.l HWIO_RXFE_WB_WBDC_EST2_LOAD_Q_WB3_ADDR A:0x64367084
y.create.l HWIO_RXFE_WB_VSRC_CFG_WB3_ADDR A:0x64367088
y.create.l HWIO_RXFE_WB_VSRC_T2BYT1M1_WB3_ADDR A:0x6436708c
y.create.l HWIO_RXFE_WB_VSRC_CMD_WB3_ADDR A:0x64367090
y.create.l HWIO_RXFE_WB_VSRC_STATUS_WB3_ADDR A:0x64367094
y.create.l HWIO_RXFE_WB_VSRC_UPDT_ACTION_SAMPLE_WB3_ADDR A:0x64367098
y.create.l HWIO_RXFE_WB_VSRC_CURR_T1BYT2_WB3_ADDR A:0x6436709c
y.create.l HWIO_RXFE_WB_VSRC_CURR_T2BYT1M1_WB3_ADDR A:0x643670a0
y.create.l HWIO_RXFE_WB_VSRC_SCTR_LOAD_VALUE_WB3_ADDR A:0x643670a4
y.create.l HWIO_RXFE_WB_VSRC_SCTR_WA_WB3_ADDR A:0x643670a8
y.create.l HWIO_RXFE_WB_VSRC_SCTR_SNAPSHOT_WB3_ADDR A:0x643670ac
y.create.l HWIO_RXFE_WB_VSRC_ACC_SNAPSHOT_WB3_ADDR A:0x643670b0
y.create.l HWIO_RXFE_WB_DEC_FILT_CFG_WB3_ADDR A:0x643670b4
y.create.l HWIO_RXFE_WB_IQMC_CFG0_WB3_ADDR A:0x643670b8
y.create.l HWIO_RXFE_WB_IQMC_CFG1_WB3_ADDR A:0x643670bc
y.create.l HWIO_RXFE_WB_IQMC_CURR_VALS_WB3_ADDR A:0x643670c0
y.create.l HWIO_RXFE_WB_IQMC_UPDT_CMD_WB3_ADDR A:0x643670c4
y.create.l HWIO_RXFE_WB_IQMC_UPDT_ACTION_SAMPLE_WB3_ADDR A:0x643670c8
y.create.l HWIO_RXFE_WB_NOTCH_FILT0_CFG0_WB3_ADDR A:0x643670cc
y.create.l HWIO_RXFE_WB_NOTCH_FILT1_CFG0_WB3_ADDR A:0x643670d4
y.create.l HWIO_RXFE_WB_NOTCH_FILT2_CFG0_WB3_ADDR A:0x643670dc
y.create.l HWIO_RXFE_WB_NOTCH_FILT0_CFG1_WB3_ADDR A:0x643670d0
y.create.l HWIO_RXFE_WB_NOTCH_FILT1_CFG1_WB3_ADDR A:0x643670d8
y.create.l HWIO_RXFE_WB_NOTCH_FILT2_CFG1_WB3_ADDR A:0x643670e0
y.create.l HWIO_RXFE_WB_NOTCH_FILT012_CFG_WB3_ADDR A:0x643670e4
y.create.l HWIO_RXFE_WB_SPARE_REG_WB3_ADDR A:0x643670e8
y.create.l HWIO_RXFE_NB_TOP_CTL_NB0_ADDR A:0x64370000
y.create.l HWIO_RXFE_NB_GATE_CMD_NB0_ADDR A:0x64370004
y.create.l HWIO_RXFE_NB_GATE_STATUS_NB0_ADDR A:0x64370008
y.create.l HWIO_RXFE_NB_GATE_ACTION_SAMPLE_NB0_ADDR A:0x6437000c
y.create.l HWIO_RXFE_NB_TIMINGCTL_STATUS_NB0_ADDR A:0x64370010
y.create.l HWIO_RXFE_NB_CSR_CFG_NB0_ADDR A:0x64370014
y.create.l HWIO_RXFE_NB_CSR_CMD_NB0_ADDR A:0x64370018
y.create.l HWIO_RXFE_NB_CSR_PHASEUPDT_ACTION_SAMPLE_NB0_ADDR A:0x6437001c
y.create.l HWIO_RXFE_NB_CSR_FREQUPDT_ACTION_SAMPLE_NB0_ADDR A:0x64370020
y.create.l HWIO_RXFE_NB_CSR_PHASE_OFFSET_NB0_ADDR A:0x64370024
y.create.l HWIO_RXFE_NB_CSR_FREQ_OFFSET_NB0_ADDR A:0x64370028
y.create.l HWIO_RXFE_NB_CSR_CURR_PHASE_OFFSET_NB0_ADDR A:0x6437002c
y.create.l HWIO_RXFE_NB_CSR_CURR_FREQ_OFFSET_NB0_ADDR A:0x64370030
y.create.l HWIO_RXFE_NB_FILTERS_CFG_NB0_ADDR A:0x64370034
y.create.l HWIO_RXFE_NB_ICI_COEF0_NB0_ADDR A:0x6437003c
y.create.l HWIO_RXFE_NB_ICI_COEF1_NB0_ADDR A:0x64370040
y.create.l HWIO_RXFE_NB_ICI_COEF2_NB0_ADDR A:0x64370044
y.create.l HWIO_RXFE_NB_ICI_COEF3_NB0_ADDR A:0x64370048
y.create.l HWIO_RXFE_NB_ICI_COEF4_NB0_ADDR A:0x6437004c
y.create.l HWIO_RXFE_NB_ICI_COEF5_NB0_ADDR A:0x64370050
y.create.l HWIO_RXFE_NB_ICI_COEF6_NB0_ADDR A:0x64370054
y.create.l HWIO_RXFE_NB_ICI_COEF7_NB0_ADDR A:0x64370058
y.create.l HWIO_RXFE_NB_ICI_COEF8_NB0_ADDR A:0x6437005c
y.create.l HWIO_RXFE_NB_ICI_COEF9_NB0_ADDR A:0x64370060
y.create.l HWIO_RXFE_NB_GDA_NB0_ADDR A:0x64370068
y.create.l HWIO_RXFE_NB_NBDC_COMPVAL_I_NB0_ADDR A:0x6437006c
y.create.l HWIO_RXFE_NB_NBDC_COMPVAL_Q_NB0_ADDR A:0x64370070
y.create.l HWIO_RXFE_NB_NBPWR_CFG_NB0_ADDR A:0x64370074
y.create.l HWIO_RXFE_NB_NBPWR_CMD_NB0_ADDR A:0x64370078
y.create.l HWIO_RXFE_NB_NBPWR_START_ACTION_SAMPLE_NB0_ADDR A:0x6437007c
y.create.l HWIO_RXFE_NB_NBPWR_START_MASK_NB0_ADDR A:0x64370080
y.create.l HWIO_RXFE_NB_NBPWR_STOP_ACTION_SAMPLE_NB0_ADDR A:0x64370084
y.create.l HWIO_RXFE_NB_NBPWR_FINAL_ACC_NB0_ADDR A:0x64370088
y.create.l HWIO_RXFE_NB_NBPWR_CURR_ACC_NB0_ADDR A:0x6437008c
y.create.l HWIO_RXFE_NB_NBPWR_MAX_ACC_NB0_ADDR A:0x64370090
y.create.l HWIO_RXFE_NB_DVGA_CFG_NB0_ADDR A:0x64370094
y.create.l HWIO_RXFE_NB_DVGA_RXFE_GAIN_NB0_ADDR A:0x64370098
y.create.l HWIO_RXFE_NB_DVGA_OVERRIDE_DVGA_GAIN_NB0_ADDR A:0x6437009c
y.create.l HWIO_RXFE_NB_DVGA_CMD_NB0_ADDR A:0x643700a0
y.create.l HWIO_RXFE_NB_DVGA_UPDT_ACTION_SAMPLE_NB0_ADDR A:0x643700a4
y.create.l HWIO_RXFE_NB_DVGA_UPDT_MASK_NB0_ADDR A:0x643700a8
y.create.l HWIO_RXFE_NB_FINAL_BITWIDTHS_CFG_NB0_ADDR A:0x643700ac
y.create.l HWIO_RXFE_NB_FINAL_SWAP_NB0_ADDR A:0x643700dc
y.create.l HWIO_RXFE_NB_WTR_CFG_NB0_ADDR A:0x643700b0
y.create.l HWIO_RXFE_NB_WTR_FUNC_CFG_NB0_ADDR A:0x643700b4
y.create.l HWIO_RXFE_NB_WTR_DBG_CFG0_NB0_ADDR A:0x643700b8
y.create.l HWIO_RXFE_NB_WTR_DBG_CFG1_NB0_ADDR A:0x643700bc
y.create.l HWIO_RXFE_NB_WTR_CMD_NB0_ADDR A:0x643700c0
y.create.l HWIO_RXFE_NB_WTR_START_ACTION_SAMPLE_NB0_ADDR A:0x643700c4
y.create.l HWIO_RXFE_NB_WTR_STOP_ACTION_SAMPLE_NB0_ADDR A:0x643700c8
y.create.l HWIO_RXFE_NB_WTR_STATUS_NB0_ADDR A:0x643700d0
y.create.l HWIO_RXFE_NB_WTR_ADDR_SNAPSHOT_NB0_ADDR A:0x643700d4
y.create.l HWIO_RXFE_NB_SPARE_REG_NB0_ADDR A:0x643700d8
y.create.l HWIO_RXFE_NB_TOP_CTL_NB1_ADDR A:0x64371000
y.create.l HWIO_RXFE_NB_GATE_CMD_NB1_ADDR A:0x64371004
y.create.l HWIO_RXFE_NB_GATE_STATUS_NB1_ADDR A:0x64371008
y.create.l HWIO_RXFE_NB_GATE_ACTION_SAMPLE_NB1_ADDR A:0x6437100c
y.create.l HWIO_RXFE_NB_TIMINGCTL_STATUS_NB1_ADDR A:0x64371010
y.create.l HWIO_RXFE_NB_CSR_CFG_NB1_ADDR A:0x64371014
y.create.l HWIO_RXFE_NB_CSR_CMD_NB1_ADDR A:0x64371018
y.create.l HWIO_RXFE_NB_CSR_PHASEUPDT_ACTION_SAMPLE_NB1_ADDR A:0x6437101c
y.create.l HWIO_RXFE_NB_CSR_FREQUPDT_ACTION_SAMPLE_NB1_ADDR A:0x64371020
y.create.l HWIO_RXFE_NB_CSR_PHASE_OFFSET_NB1_ADDR A:0x64371024
y.create.l HWIO_RXFE_NB_CSR_FREQ_OFFSET_NB1_ADDR A:0x64371028
y.create.l HWIO_RXFE_NB_CSR_CURR_PHASE_OFFSET_NB1_ADDR A:0x6437102c
y.create.l HWIO_RXFE_NB_CSR_CURR_FREQ_OFFSET_NB1_ADDR A:0x64371030
y.create.l HWIO_RXFE_NB_FILTERS_CFG_NB1_ADDR A:0x64371034
y.create.l HWIO_RXFE_NB_ICI_COEF0_NB1_ADDR A:0x6437103c
y.create.l HWIO_RXFE_NB_ICI_COEF1_NB1_ADDR A:0x64371040
y.create.l HWIO_RXFE_NB_ICI_COEF2_NB1_ADDR A:0x64371044
y.create.l HWIO_RXFE_NB_ICI_COEF3_NB1_ADDR A:0x64371048
y.create.l HWIO_RXFE_NB_ICI_COEF4_NB1_ADDR A:0x6437104c
y.create.l HWIO_RXFE_NB_ICI_COEF5_NB1_ADDR A:0x64371050
y.create.l HWIO_RXFE_NB_ICI_COEF6_NB1_ADDR A:0x64371054
y.create.l HWIO_RXFE_NB_ICI_COEF7_NB1_ADDR A:0x64371058
y.create.l HWIO_RXFE_NB_ICI_COEF8_NB1_ADDR A:0x6437105c
y.create.l HWIO_RXFE_NB_ICI_COEF9_NB1_ADDR A:0x64371060
y.create.l HWIO_RXFE_NB_GDA_NB1_ADDR A:0x64371068
y.create.l HWIO_RXFE_NB_NBDC_COMPVAL_I_NB1_ADDR A:0x6437106c
y.create.l HWIO_RXFE_NB_NBDC_COMPVAL_Q_NB1_ADDR A:0x64371070
y.create.l HWIO_RXFE_NB_NBPWR_CFG_NB1_ADDR A:0x64371074
y.create.l HWIO_RXFE_NB_NBPWR_CMD_NB1_ADDR A:0x64371078
y.create.l HWIO_RXFE_NB_NBPWR_START_ACTION_SAMPLE_NB1_ADDR A:0x6437107c
y.create.l HWIO_RXFE_NB_NBPWR_START_MASK_NB1_ADDR A:0x64371080
y.create.l HWIO_RXFE_NB_NBPWR_STOP_ACTION_SAMPLE_NB1_ADDR A:0x64371084
y.create.l HWIO_RXFE_NB_NBPWR_FINAL_ACC_NB1_ADDR A:0x64371088
y.create.l HWIO_RXFE_NB_NBPWR_CURR_ACC_NB1_ADDR A:0x6437108c
y.create.l HWIO_RXFE_NB_NBPWR_MAX_ACC_NB1_ADDR A:0x64371090
y.create.l HWIO_RXFE_NB_DVGA_CFG_NB1_ADDR A:0x64371094
y.create.l HWIO_RXFE_NB_DVGA_RXFE_GAIN_NB1_ADDR A:0x64371098
y.create.l HWIO_RXFE_NB_DVGA_OVERRIDE_DVGA_GAIN_NB1_ADDR A:0x6437109c
y.create.l HWIO_RXFE_NB_DVGA_CMD_NB1_ADDR A:0x643710a0
y.create.l HWIO_RXFE_NB_DVGA_UPDT_ACTION_SAMPLE_NB1_ADDR A:0x643710a4
y.create.l HWIO_RXFE_NB_DVGA_UPDT_MASK_NB1_ADDR A:0x643710a8
y.create.l HWIO_RXFE_NB_FINAL_BITWIDTHS_CFG_NB1_ADDR A:0x643710ac
y.create.l HWIO_RXFE_NB_FINAL_SWAP_NB1_ADDR A:0x643710dc
y.create.l HWIO_RXFE_NB_WTR_CFG_NB1_ADDR A:0x643710b0
y.create.l HWIO_RXFE_NB_WTR_FUNC_CFG_NB1_ADDR A:0x643710b4
y.create.l HWIO_RXFE_NB_WTR_DBG_CFG0_NB1_ADDR A:0x643710b8
y.create.l HWIO_RXFE_NB_WTR_DBG_CFG1_NB1_ADDR A:0x643710bc
y.create.l HWIO_RXFE_NB_WTR_CMD_NB1_ADDR A:0x643710c0
y.create.l HWIO_RXFE_NB_WTR_START_ACTION_SAMPLE_NB1_ADDR A:0x643710c4
y.create.l HWIO_RXFE_NB_WTR_STOP_ACTION_SAMPLE_NB1_ADDR A:0x643710c8
y.create.l HWIO_RXFE_NB_WTR_STATUS_NB1_ADDR A:0x643710d0
y.create.l HWIO_RXFE_NB_WTR_ADDR_SNAPSHOT_NB1_ADDR A:0x643710d4
y.create.l HWIO_RXFE_NB_SPARE_REG_NB1_ADDR A:0x643710d8
y.create.l HWIO_RXFE_NB_TOP_CTL_NB2_ADDR A:0x64372000
y.create.l HWIO_RXFE_NB_GATE_CMD_NB2_ADDR A:0x64372004
y.create.l HWIO_RXFE_NB_GATE_STATUS_NB2_ADDR A:0x64372008
y.create.l HWIO_RXFE_NB_GATE_ACTION_SAMPLE_NB2_ADDR A:0x6437200c
y.create.l HWIO_RXFE_NB_TIMINGCTL_STATUS_NB2_ADDR A:0x64372010
y.create.l HWIO_RXFE_NB_CSR_CFG_NB2_ADDR A:0x64372014
y.create.l HWIO_RXFE_NB_CSR_CMD_NB2_ADDR A:0x64372018
y.create.l HWIO_RXFE_NB_CSR_PHASEUPDT_ACTION_SAMPLE_NB2_ADDR A:0x6437201c
y.create.l HWIO_RXFE_NB_CSR_FREQUPDT_ACTION_SAMPLE_NB2_ADDR A:0x64372020
y.create.l HWIO_RXFE_NB_CSR_PHASE_OFFSET_NB2_ADDR A:0x64372024
y.create.l HWIO_RXFE_NB_CSR_FREQ_OFFSET_NB2_ADDR A:0x64372028
y.create.l HWIO_RXFE_NB_CSR_CURR_PHASE_OFFSET_NB2_ADDR A:0x6437202c
y.create.l HWIO_RXFE_NB_CSR_CURR_FREQ_OFFSET_NB2_ADDR A:0x64372030
y.create.l HWIO_RXFE_NB_FILTERS_CFG_NB2_ADDR A:0x64372034
y.create.l HWIO_RXFE_NB_ICI_COEF0_NB2_ADDR A:0x6437203c
y.create.l HWIO_RXFE_NB_ICI_COEF1_NB2_ADDR A:0x64372040
y.create.l HWIO_RXFE_NB_ICI_COEF2_NB2_ADDR A:0x64372044
y.create.l HWIO_RXFE_NB_ICI_COEF3_NB2_ADDR A:0x64372048
y.create.l HWIO_RXFE_NB_ICI_COEF4_NB2_ADDR A:0x6437204c
y.create.l HWIO_RXFE_NB_ICI_COEF5_NB2_ADDR A:0x64372050
y.create.l HWIO_RXFE_NB_ICI_COEF6_NB2_ADDR A:0x64372054
y.create.l HWIO_RXFE_NB_ICI_COEF7_NB2_ADDR A:0x64372058
y.create.l HWIO_RXFE_NB_ICI_COEF8_NB2_ADDR A:0x6437205c
y.create.l HWIO_RXFE_NB_ICI_COEF9_NB2_ADDR A:0x64372060
y.create.l HWIO_RXFE_NB_GDA_NB2_ADDR A:0x64372068
y.create.l HWIO_RXFE_NB_NBDC_COMPVAL_I_NB2_ADDR A:0x6437206c
y.create.l HWIO_RXFE_NB_NBDC_COMPVAL_Q_NB2_ADDR A:0x64372070
y.create.l HWIO_RXFE_NB_NBPWR_CFG_NB2_ADDR A:0x64372074
y.create.l HWIO_RXFE_NB_NBPWR_CMD_NB2_ADDR A:0x64372078
y.create.l HWIO_RXFE_NB_NBPWR_START_ACTION_SAMPLE_NB2_ADDR A:0x6437207c
y.create.l HWIO_RXFE_NB_NBPWR_START_MASK_NB2_ADDR A:0x64372080
y.create.l HWIO_RXFE_NB_NBPWR_STOP_ACTION_SAMPLE_NB2_ADDR A:0x64372084
y.create.l HWIO_RXFE_NB_NBPWR_FINAL_ACC_NB2_ADDR A:0x64372088
y.create.l HWIO_RXFE_NB_NBPWR_CURR_ACC_NB2_ADDR A:0x6437208c
y.create.l HWIO_RXFE_NB_NBPWR_MAX_ACC_NB2_ADDR A:0x64372090
y.create.l HWIO_RXFE_NB_DVGA_CFG_NB2_ADDR A:0x64372094
y.create.l HWIO_RXFE_NB_DVGA_RXFE_GAIN_NB2_ADDR A:0x64372098
y.create.l HWIO_RXFE_NB_DVGA_OVERRIDE_DVGA_GAIN_NB2_ADDR A:0x6437209c
y.create.l HWIO_RXFE_NB_DVGA_CMD_NB2_ADDR A:0x643720a0
y.create.l HWIO_RXFE_NB_DVGA_UPDT_ACTION_SAMPLE_NB2_ADDR A:0x643720a4
y.create.l HWIO_RXFE_NB_DVGA_UPDT_MASK_NB2_ADDR A:0x643720a8
y.create.l HWIO_RXFE_NB_FINAL_BITWIDTHS_CFG_NB2_ADDR A:0x643720ac
y.create.l HWIO_RXFE_NB_FINAL_SWAP_NB2_ADDR A:0x643720dc
y.create.l HWIO_RXFE_NB_WTR_CFG_NB2_ADDR A:0x643720b0
y.create.l HWIO_RXFE_NB_WTR_FUNC_CFG_NB2_ADDR A:0x643720b4
y.create.l HWIO_RXFE_NB_WTR_DBG_CFG0_NB2_ADDR A:0x643720b8
y.create.l HWIO_RXFE_NB_WTR_DBG_CFG1_NB2_ADDR A:0x643720bc
y.create.l HWIO_RXFE_NB_WTR_CMD_NB2_ADDR A:0x643720c0
y.create.l HWIO_RXFE_NB_WTR_START_ACTION_SAMPLE_NB2_ADDR A:0x643720c4
y.create.l HWIO_RXFE_NB_WTR_STOP_ACTION_SAMPLE_NB2_ADDR A:0x643720c8
y.create.l HWIO_RXFE_NB_WTR_STATUS_NB2_ADDR A:0x643720d0
y.create.l HWIO_RXFE_NB_WTR_ADDR_SNAPSHOT_NB2_ADDR A:0x643720d4
y.create.l HWIO_RXFE_NB_SPARE_REG_NB2_ADDR A:0x643720d8
y.create.l HWIO_RXFE_NB_TOP_CTL_NB3_ADDR A:0x64373000
y.create.l HWIO_RXFE_NB_GATE_CMD_NB3_ADDR A:0x64373004
y.create.l HWIO_RXFE_NB_GATE_STATUS_NB3_ADDR A:0x64373008
y.create.l HWIO_RXFE_NB_GATE_ACTION_SAMPLE_NB3_ADDR A:0x6437300c
y.create.l HWIO_RXFE_NB_TIMINGCTL_STATUS_NB3_ADDR A:0x64373010
y.create.l HWIO_RXFE_NB_CSR_CFG_NB3_ADDR A:0x64373014
y.create.l HWIO_RXFE_NB_CSR_CMD_NB3_ADDR A:0x64373018
y.create.l HWIO_RXFE_NB_CSR_PHASEUPDT_ACTION_SAMPLE_NB3_ADDR A:0x6437301c
y.create.l HWIO_RXFE_NB_CSR_FREQUPDT_ACTION_SAMPLE_NB3_ADDR A:0x64373020
y.create.l HWIO_RXFE_NB_CSR_PHASE_OFFSET_NB3_ADDR A:0x64373024
y.create.l HWIO_RXFE_NB_CSR_FREQ_OFFSET_NB3_ADDR A:0x64373028
y.create.l HWIO_RXFE_NB_CSR_CURR_PHASE_OFFSET_NB3_ADDR A:0x6437302c
y.create.l HWIO_RXFE_NB_CSR_CURR_FREQ_OFFSET_NB3_ADDR A:0x64373030
y.create.l HWIO_RXFE_NB_FILTERS_CFG_NB3_ADDR A:0x64373034
y.create.l HWIO_RXFE_NB_ICI_COEF0_NB3_ADDR A:0x6437303c
y.create.l HWIO_RXFE_NB_ICI_COEF1_NB3_ADDR A:0x64373040
y.create.l HWIO_RXFE_NB_ICI_COEF2_NB3_ADDR A:0x64373044
y.create.l HWIO_RXFE_NB_ICI_COEF3_NB3_ADDR A:0x64373048
y.create.l HWIO_RXFE_NB_ICI_COEF4_NB3_ADDR A:0x6437304c
y.create.l HWIO_RXFE_NB_ICI_COEF5_NB3_ADDR A:0x64373050
y.create.l HWIO_RXFE_NB_ICI_COEF6_NB3_ADDR A:0x64373054
y.create.l HWIO_RXFE_NB_ICI_COEF7_NB3_ADDR A:0x64373058
y.create.l HWIO_RXFE_NB_ICI_COEF8_NB3_ADDR A:0x6437305c
y.create.l HWIO_RXFE_NB_ICI_COEF9_NB3_ADDR A:0x64373060
y.create.l HWIO_RXFE_NB_GDA_NB3_ADDR A:0x64373068
y.create.l HWIO_RXFE_NB_NBDC_COMPVAL_I_NB3_ADDR A:0x6437306c
y.create.l HWIO_RXFE_NB_NBDC_COMPVAL_Q_NB3_ADDR A:0x64373070
y.create.l HWIO_RXFE_NB_NBPWR_CFG_NB3_ADDR A:0x64373074
y.create.l HWIO_RXFE_NB_NBPWR_CMD_NB3_ADDR A:0x64373078
y.create.l HWIO_RXFE_NB_NBPWR_START_ACTION_SAMPLE_NB3_ADDR A:0x6437307c
y.create.l HWIO_RXFE_NB_NBPWR_START_MASK_NB3_ADDR A:0x64373080
y.create.l HWIO_RXFE_NB_NBPWR_STOP_ACTION_SAMPLE_NB3_ADDR A:0x64373084
y.create.l HWIO_RXFE_NB_NBPWR_FINAL_ACC_NB3_ADDR A:0x64373088
y.create.l HWIO_RXFE_NB_NBPWR_CURR_ACC_NB3_ADDR A:0x6437308c
y.create.l HWIO_RXFE_NB_NBPWR_MAX_ACC_NB3_ADDR A:0x64373090
y.create.l HWIO_RXFE_NB_DVGA_CFG_NB3_ADDR A:0x64373094
y.create.l HWIO_RXFE_NB_DVGA_RXFE_GAIN_NB3_ADDR A:0x64373098
y.create.l HWIO_RXFE_NB_DVGA_OVERRIDE_DVGA_GAIN_NB3_ADDR A:0x6437309c
y.create.l HWIO_RXFE_NB_DVGA_CMD_NB3_ADDR A:0x643730a0
y.create.l HWIO_RXFE_NB_DVGA_UPDT_ACTION_SAMPLE_NB3_ADDR A:0x643730a4
y.create.l HWIO_RXFE_NB_DVGA_UPDT_MASK_NB3_ADDR A:0x643730a8
y.create.l HWIO_RXFE_NB_FINAL_BITWIDTHS_CFG_NB3_ADDR A:0x643730ac
y.create.l HWIO_RXFE_NB_FINAL_SWAP_NB3_ADDR A:0x643730dc
y.create.l HWIO_RXFE_NB_WTR_CFG_NB3_ADDR A:0x643730b0
y.create.l HWIO_RXFE_NB_WTR_FUNC_CFG_NB3_ADDR A:0x643730b4
y.create.l HWIO_RXFE_NB_WTR_DBG_CFG0_NB3_ADDR A:0x643730b8
y.create.l HWIO_RXFE_NB_WTR_DBG_CFG1_NB3_ADDR A:0x643730bc
y.create.l HWIO_RXFE_NB_WTR_CMD_NB3_ADDR A:0x643730c0
y.create.l HWIO_RXFE_NB_WTR_START_ACTION_SAMPLE_NB3_ADDR A:0x643730c4
y.create.l HWIO_RXFE_NB_WTR_STOP_ACTION_SAMPLE_NB3_ADDR A:0x643730c8
y.create.l HWIO_RXFE_NB_WTR_STATUS_NB3_ADDR A:0x643730d0
y.create.l HWIO_RXFE_NB_WTR_ADDR_SNAPSHOT_NB3_ADDR A:0x643730d4
y.create.l HWIO_RXFE_NB_SPARE_REG_NB3_ADDR A:0x643730d8
y.create.l HWIO_RXFE_NB_TOP_CTL_NB4_ADDR A:0x64374000
y.create.l HWIO_RXFE_NB_GATE_CMD_NB4_ADDR A:0x64374004
y.create.l HWIO_RXFE_NB_GATE_STATUS_NB4_ADDR A:0x64374008
y.create.l HWIO_RXFE_NB_GATE_ACTION_SAMPLE_NB4_ADDR A:0x6437400c
y.create.l HWIO_RXFE_NB_TIMINGCTL_STATUS_NB4_ADDR A:0x64374010
y.create.l HWIO_RXFE_NB_CSR_CFG_NB4_ADDR A:0x64374014
y.create.l HWIO_RXFE_NB_CSR_CMD_NB4_ADDR A:0x64374018
y.create.l HWIO_RXFE_NB_CSR_PHASEUPDT_ACTION_SAMPLE_NB4_ADDR A:0x6437401c
y.create.l HWIO_RXFE_NB_CSR_FREQUPDT_ACTION_SAMPLE_NB4_ADDR A:0x64374020
y.create.l HWIO_RXFE_NB_CSR_PHASE_OFFSET_NB4_ADDR A:0x64374024
y.create.l HWIO_RXFE_NB_CSR_FREQ_OFFSET_NB4_ADDR A:0x64374028
y.create.l HWIO_RXFE_NB_CSR_CURR_PHASE_OFFSET_NB4_ADDR A:0x6437402c
y.create.l HWIO_RXFE_NB_CSR_CURR_FREQ_OFFSET_NB4_ADDR A:0x64374030
y.create.l HWIO_RXFE_NB_FILTERS_CFG_NB4_ADDR A:0x64374034
y.create.l HWIO_RXFE_NB_ICI_COEF0_NB4_ADDR A:0x6437403c
y.create.l HWIO_RXFE_NB_ICI_COEF1_NB4_ADDR A:0x64374040
y.create.l HWIO_RXFE_NB_ICI_COEF2_NB4_ADDR A:0x64374044
y.create.l HWIO_RXFE_NB_ICI_COEF3_NB4_ADDR A:0x64374048
y.create.l HWIO_RXFE_NB_ICI_COEF4_NB4_ADDR A:0x6437404c
y.create.l HWIO_RXFE_NB_ICI_COEF5_NB4_ADDR A:0x64374050
y.create.l HWIO_RXFE_NB_ICI_COEF6_NB4_ADDR A:0x64374054
y.create.l HWIO_RXFE_NB_ICI_COEF7_NB4_ADDR A:0x64374058
y.create.l HWIO_RXFE_NB_ICI_COEF8_NB4_ADDR A:0x6437405c
y.create.l HWIO_RXFE_NB_ICI_COEF9_NB4_ADDR A:0x64374060
y.create.l HWIO_RXFE_NB_GDA_NB4_ADDR A:0x64374068
y.create.l HWIO_RXFE_NB_NBDC_COMPVAL_I_NB4_ADDR A:0x6437406c
y.create.l HWIO_RXFE_NB_NBDC_COMPVAL_Q_NB4_ADDR A:0x64374070
y.create.l HWIO_RXFE_NB_NBPWR_CFG_NB4_ADDR A:0x64374074
y.create.l HWIO_RXFE_NB_NBPWR_CMD_NB4_ADDR A:0x64374078
y.create.l HWIO_RXFE_NB_NBPWR_START_ACTION_SAMPLE_NB4_ADDR A:0x6437407c
y.create.l HWIO_RXFE_NB_NBPWR_START_MASK_NB4_ADDR A:0x64374080
y.create.l HWIO_RXFE_NB_NBPWR_STOP_ACTION_SAMPLE_NB4_ADDR A:0x64374084
y.create.l HWIO_RXFE_NB_NBPWR_FINAL_ACC_NB4_ADDR A:0x64374088
y.create.l HWIO_RXFE_NB_NBPWR_CURR_ACC_NB4_ADDR A:0x6437408c
y.create.l HWIO_RXFE_NB_NBPWR_MAX_ACC_NB4_ADDR A:0x64374090
y.create.l HWIO_RXFE_NB_DVGA_CFG_NB4_ADDR A:0x64374094
y.create.l HWIO_RXFE_NB_DVGA_RXFE_GAIN_NB4_ADDR A:0x64374098
y.create.l HWIO_RXFE_NB_DVGA_OVERRIDE_DVGA_GAIN_NB4_ADDR A:0x6437409c
y.create.l HWIO_RXFE_NB_DVGA_CMD_NB4_ADDR A:0x643740a0
y.create.l HWIO_RXFE_NB_DVGA_UPDT_ACTION_SAMPLE_NB4_ADDR A:0x643740a4
y.create.l HWIO_RXFE_NB_DVGA_UPDT_MASK_NB4_ADDR A:0x643740a8
y.create.l HWIO_RXFE_NB_FINAL_BITWIDTHS_CFG_NB4_ADDR A:0x643740ac
y.create.l HWIO_RXFE_NB_FINAL_SWAP_NB4_ADDR A:0x643740dc
y.create.l HWIO_RXFE_NB_WTR_CFG_NB4_ADDR A:0x643740b0
y.create.l HWIO_RXFE_NB_WTR_FUNC_CFG_NB4_ADDR A:0x643740b4
y.create.l HWIO_RXFE_NB_WTR_DBG_CFG0_NB4_ADDR A:0x643740b8
y.create.l HWIO_RXFE_NB_WTR_DBG_CFG1_NB4_ADDR A:0x643740bc
y.create.l HWIO_RXFE_NB_WTR_CMD_NB4_ADDR A:0x643740c0
y.create.l HWIO_RXFE_NB_WTR_START_ACTION_SAMPLE_NB4_ADDR A:0x643740c4
y.create.l HWIO_RXFE_NB_WTR_STOP_ACTION_SAMPLE_NB4_ADDR A:0x643740c8
y.create.l HWIO_RXFE_NB_WTR_STATUS_NB4_ADDR A:0x643740d0
y.create.l HWIO_RXFE_NB_WTR_ADDR_SNAPSHOT_NB4_ADDR A:0x643740d4
y.create.l HWIO_RXFE_NB_SPARE_REG_NB4_ADDR A:0x643740d8
y.create.l HWIO_RXFE_NB_TOP_CTL_NB5_ADDR A:0x64375000
y.create.l HWIO_RXFE_NB_GATE_CMD_NB5_ADDR A:0x64375004
y.create.l HWIO_RXFE_NB_GATE_STATUS_NB5_ADDR A:0x64375008
y.create.l HWIO_RXFE_NB_GATE_ACTION_SAMPLE_NB5_ADDR A:0x6437500c
y.create.l HWIO_RXFE_NB_TIMINGCTL_STATUS_NB5_ADDR A:0x64375010
y.create.l HWIO_RXFE_NB_CSR_CFG_NB5_ADDR A:0x64375014
y.create.l HWIO_RXFE_NB_CSR_CMD_NB5_ADDR A:0x64375018
y.create.l HWIO_RXFE_NB_CSR_PHASEUPDT_ACTION_SAMPLE_NB5_ADDR A:0x6437501c
y.create.l HWIO_RXFE_NB_CSR_FREQUPDT_ACTION_SAMPLE_NB5_ADDR A:0x64375020
y.create.l HWIO_RXFE_NB_CSR_PHASE_OFFSET_NB5_ADDR A:0x64375024
y.create.l HWIO_RXFE_NB_CSR_FREQ_OFFSET_NB5_ADDR A:0x64375028
y.create.l HWIO_RXFE_NB_CSR_CURR_PHASE_OFFSET_NB5_ADDR A:0x6437502c
y.create.l HWIO_RXFE_NB_CSR_CURR_FREQ_OFFSET_NB5_ADDR A:0x64375030
y.create.l HWIO_RXFE_NB_FILTERS_CFG_NB5_ADDR A:0x64375034
y.create.l HWIO_RXFE_NB_ICI_COEF0_NB5_ADDR A:0x6437503c
y.create.l HWIO_RXFE_NB_ICI_COEF1_NB5_ADDR A:0x64375040
y.create.l HWIO_RXFE_NB_ICI_COEF2_NB5_ADDR A:0x64375044
y.create.l HWIO_RXFE_NB_ICI_COEF3_NB5_ADDR A:0x64375048
y.create.l HWIO_RXFE_NB_ICI_COEF4_NB5_ADDR A:0x6437504c
y.create.l HWIO_RXFE_NB_ICI_COEF5_NB5_ADDR A:0x64375050
y.create.l HWIO_RXFE_NB_ICI_COEF6_NB5_ADDR A:0x64375054
y.create.l HWIO_RXFE_NB_ICI_COEF7_NB5_ADDR A:0x64375058
y.create.l HWIO_RXFE_NB_ICI_COEF8_NB5_ADDR A:0x6437505c
y.create.l HWIO_RXFE_NB_ICI_COEF9_NB5_ADDR A:0x64375060
y.create.l HWIO_RXFE_NB_GDA_NB5_ADDR A:0x64375068
y.create.l HWIO_RXFE_NB_NBDC_COMPVAL_I_NB5_ADDR A:0x6437506c
y.create.l HWIO_RXFE_NB_NBDC_COMPVAL_Q_NB5_ADDR A:0x64375070
y.create.l HWIO_RXFE_NB_NBPWR_CFG_NB5_ADDR A:0x64375074
y.create.l HWIO_RXFE_NB_NBPWR_CMD_NB5_ADDR A:0x64375078
y.create.l HWIO_RXFE_NB_NBPWR_START_ACTION_SAMPLE_NB5_ADDR A:0x6437507c
y.create.l HWIO_RXFE_NB_NBPWR_START_MASK_NB5_ADDR A:0x64375080
y.create.l HWIO_RXFE_NB_NBPWR_STOP_ACTION_SAMPLE_NB5_ADDR A:0x64375084
y.create.l HWIO_RXFE_NB_NBPWR_FINAL_ACC_NB5_ADDR A:0x64375088
y.create.l HWIO_RXFE_NB_NBPWR_CURR_ACC_NB5_ADDR A:0x6437508c
y.create.l HWIO_RXFE_NB_NBPWR_MAX_ACC_NB5_ADDR A:0x64375090
y.create.l HWIO_RXFE_NB_DVGA_CFG_NB5_ADDR A:0x64375094
y.create.l HWIO_RXFE_NB_DVGA_RXFE_GAIN_NB5_ADDR A:0x64375098
y.create.l HWIO_RXFE_NB_DVGA_OVERRIDE_DVGA_GAIN_NB5_ADDR A:0x6437509c
y.create.l HWIO_RXFE_NB_DVGA_CMD_NB5_ADDR A:0x643750a0
y.create.l HWIO_RXFE_NB_DVGA_UPDT_ACTION_SAMPLE_NB5_ADDR A:0x643750a4
y.create.l HWIO_RXFE_NB_DVGA_UPDT_MASK_NB5_ADDR A:0x643750a8
y.create.l HWIO_RXFE_NB_FINAL_BITWIDTHS_CFG_NB5_ADDR A:0x643750ac
y.create.l HWIO_RXFE_NB_FINAL_SWAP_NB5_ADDR A:0x643750dc
y.create.l HWIO_RXFE_NB_WTR_CFG_NB5_ADDR A:0x643750b0
y.create.l HWIO_RXFE_NB_WTR_FUNC_CFG_NB5_ADDR A:0x643750b4
y.create.l HWIO_RXFE_NB_WTR_DBG_CFG0_NB5_ADDR A:0x643750b8
y.create.l HWIO_RXFE_NB_WTR_DBG_CFG1_NB5_ADDR A:0x643750bc
y.create.l HWIO_RXFE_NB_WTR_CMD_NB5_ADDR A:0x643750c0
y.create.l HWIO_RXFE_NB_WTR_START_ACTION_SAMPLE_NB5_ADDR A:0x643750c4
y.create.l HWIO_RXFE_NB_WTR_STOP_ACTION_SAMPLE_NB5_ADDR A:0x643750c8
y.create.l HWIO_RXFE_NB_WTR_STATUS_NB5_ADDR A:0x643750d0
y.create.l HWIO_RXFE_NB_WTR_ADDR_SNAPSHOT_NB5_ADDR A:0x643750d4
y.create.l HWIO_RXFE_NB_SPARE_REG_NB5_ADDR A:0x643750d8
y.create.l HWIO_RXFE_WRTR0_CFG0_ADDR A:0x6437f000
y.create.l HWIO_RXFE_WRTR1_CFG0_ADDR A:0x6437f008
y.create.l HWIO_RXFE_WRTR2_CFG0_ADDR A:0x6437f010
y.create.l HWIO_RXFE_WRTR3_CFG0_ADDR A:0x6437f018
y.create.l HWIO_RXFE_WRTR4_CFG0_ADDR A:0x6437f020
y.create.l HWIO_RXFE_WRTR5_CFG0_ADDR A:0x6437f028
y.create.l HWIO_RXFE_WRTR0_CFG1_ADDR A:0x6437f004
y.create.l HWIO_RXFE_WRTR1_CFG1_ADDR A:0x6437f00c
y.create.l HWIO_RXFE_WRTR2_CFG1_ADDR A:0x6437f014
y.create.l HWIO_RXFE_WRTR3_CFG1_ADDR A:0x6437f01c
y.create.l HWIO_RXFE_WRTR4_CFG1_ADDR A:0x6437f024
y.create.l HWIO_RXFE_WRTR5_CFG1_ADDR A:0x6437f02c
y.create.l HWIO_RXFE_WRTR_XFER_CTL_ADDR A:0x6437f040
y.create.l HWIO_RXFE_BRDG_CTL_ADDR A:0x6437f044
y.create.l HWIO_RXFE_BRDG_STATUS_ADDR A:0x6437f048
y.create.l HWIO_RXFE_BRDG_CLEAR_ADDR A:0x6437f04c
y.create.l HWIO_RXFE_BRDG_ARB_PRI_ADDR A:0x6437f050
y.create.l HWIO_RXFE_BRDG_AXI_PRI_ADDR A:0x6437f054
y.create.l HWIO_RXFE_BRDG_AXI_IDLE_CNT0_ADDR A:0x6437f058
y.create.l HWIO_RXFE_BRDG_AXI_IDLE_CNT1_ADDR A:0x6437f060
y.create.l HWIO_RXFE_BRDG_AXI_IDLE_CNT2_ADDR A:0x6437f068
y.create.l HWIO_RXFE_BRDG_AXI_IDLE_CNT3_ADDR A:0x6437f070
y.create.l HWIO_RXFE_BRDG_AXI_IDLE_CNT4_ADDR A:0x6437f078
y.create.l HWIO_RXFE_BRDG_AXI_IDLE_CNT5_ADDR A:0x6437f080
y.create.l HWIO_DEMBACK_EN_ADDR A:0x64340000
y.create.l HWIO_DEMBACK_MODE_SEL_ADDR A:0x64340004
y.create.l HWIO_DEMBACK_AHB_ERR_ADDR A:0x64340008
y.create.l HWIO_DEMBACK_MISC_ERR_DET_ADDR A:0x64340010
y.create.l HWIO_DEMBACK_MISC_ERR_CLR_ADDR A:0x64340014
y.create.l HWIO_DEMBACK_RDR0_XFER_CTL_ADDR A:0x64340100
y.create.l HWIO_DEMBACK_RDR0_CTX0_CFG0_ADDR A:0x64340108
y.create.l HWIO_DEMBACK_RDR0_CTX0_CFG1_ADDR A:0x6434010c
y.create.l HWIO_DEMBACK_RDR0_CTX1_CFG0_ADDR A:0x64340110
y.create.l HWIO_DEMBACK_RDR0_CTX1_CFG1_ADDR A:0x64340114
y.create.l HWIO_DEMBACK_RDR0_CTX2_CFG0_ADDR A:0x64340118
y.create.l HWIO_DEMBACK_RDR0_CTX2_CFG1_ADDR A:0x6434011c
y.create.l HWIO_DEMBACK_RDR0_CTX3_CFG0_ADDR A:0x64340120
y.create.l HWIO_DEMBACK_RDR0_CTX3_CFG1_ADDR A:0x64340124
y.create.l HWIO_DEMBACK_RDR1_XFER_CTL_ADDR A:0x64340148
y.create.l HWIO_DEMBACK_RDR1_CFG0_ADDR A:0x6434014c
y.create.l HWIO_DEMBACK_RDR1_CFG1_ADDR A:0x64340150
y.create.l HWIO_DEMBACK_RDR2_XFER_CTL_ADDR A:0x64340154
y.create.l HWIO_DEMBACK_RDR2_CFG0_ADDR A:0x64340158
y.create.l HWIO_DEMBACK_RDR2_CFG1_ADDR A:0x6434015c
y.create.l HWIO_DEMBACK_BRDG_CTL_ADDR A:0x64340190
y.create.l HWIO_DEMBACK_BRDG_STATUS_ADDR A:0x64340194
y.create.l HWIO_DEMBACK_BRDG_CLEAR_ADDR A:0x64340198
y.create.l HWIO_DEMBACK_BRDG_AXI_PRI_ADDR A:0x643401a0
y.create.l HWIO_DEMBACK_DBG_CTL_ADDR A:0x643401ac
y.create.l HWIO_LTE_DBE_PHICH_STATUS_ADDR A:0x64341000
y.create.l HWIO_LTE_DBE_PCFICH_STATUS_ADDR A:0x64341004
y.create.l HWIO_LTE_DBE_SCRAMBLE_SEED_FF_X1_SEED_ADDR A:0x64341008
y.create.l HWIO_LTE_DBE_TESTBUS_ENABLE_ADDR A:0x6434100c
y.create.l HWIO_LTE_DBE_TESTBUS_STATUS_ADDR A:0x64341010
y.create.l HWIO_LTE_DBE_PBCH_CMD_COUNT_ADDR A:0x64341014
y.create.l HWIO_LTE_DBE_PDCCH_CMD_COUNT_ADDR A:0x64341018
y.create.l HWIO_LTE_DBE_PDSCH_CMD_COUNT_ADDR A:0x6434101c
y.create.l HWIO_LTE_DBE_PBCH_DONE_COUNT_ADDR A:0x64341020
y.create.l HWIO_LTE_DBE_PDCCH_DONE_COUNT_ADDR A:0x64341024
y.create.l HWIO_LTE_DBE_PDSCH_DONE_COUNT_ADDR A:0x64341028
y.create.l HWIO_LTE_CFG_ADDR A:0x6434102c
y.create.l HWIO_DBACK_AMP_EST0_0_ADDR A:0x64342000
y.create.l HWIO_DBACK_AMP_EST0_1_ADDR A:0x64342008
y.create.l HWIO_DBACK_AMP_EST0_2_ADDR A:0x64342010
y.create.l HWIO_DBACK_AMP_EST0_3_ADDR A:0x64342018
y.create.l HWIO_DBACK_AMP_EST0_4_ADDR A:0x64342020
y.create.l HWIO_DBACK_AMP_EST0_5_ADDR A:0x64342028
y.create.l HWIO_DBACK_ENG_EST0_0_ADDR A:0x64342004
y.create.l HWIO_DBACK_ENG_EST0_1_ADDR A:0x6434200c
y.create.l HWIO_DBACK_ENG_EST0_2_ADDR A:0x64342014
y.create.l HWIO_DBACK_ENG_EST0_3_ADDR A:0x6434201c
y.create.l HWIO_DBACK_ENG_EST0_4_ADDR A:0x64342024
y.create.l HWIO_DBACK_ENG_EST0_5_ADDR A:0x6434202c
y.create.l HWIO_DBACK_AMP_EST1_0_ADDR A:0x64342030
y.create.l HWIO_DBACK_AMP_EST1_1_ADDR A:0x64342038
y.create.l HWIO_DBACK_AMP_EST1_2_ADDR A:0x64342040
y.create.l HWIO_DBACK_AMP_EST1_3_ADDR A:0x64342048
y.create.l HWIO_DBACK_AMP_EST1_4_ADDR A:0x64342050
y.create.l HWIO_DBACK_AMP_EST1_5_ADDR A:0x64342058
y.create.l HWIO_DBACK_ENG_EST1_0_ADDR A:0x64342034
y.create.l HWIO_DBACK_ENG_EST1_1_ADDR A:0x6434203c
y.create.l HWIO_DBACK_ENG_EST1_2_ADDR A:0x64342044
y.create.l HWIO_DBACK_ENG_EST1_3_ADDR A:0x6434204c
y.create.l HWIO_DBACK_ENG_EST1_4_ADDR A:0x64342054
y.create.l HWIO_DBACK_ENG_EST1_5_ADDR A:0x6434205c
y.create.l HWIO_DBACK_HS_CH0_PART1_DEC_DATA0_ADDR A:0x64342060
y.create.l HWIO_DBACK_HS_CH1_PART1_DEC_DATA0_ADDR A:0x6434206c
y.create.l HWIO_DBACK_HS_CH2_PART1_DEC_DATA0_ADDR A:0x64342078
y.create.l HWIO_DBACK_HS_CH3_PART1_DEC_DATA0_ADDR A:0x64342084
y.create.l HWIO_DBACK_HS_CH4_PART1_DEC_DATA0_ADDR A:0x64342090
y.create.l HWIO_DBACK_HS_CH5_PART1_DEC_DATA0_ADDR A:0x6434209c
y.create.l HWIO_DBACK_HS_CH6_PART1_DEC_DATA0_ADDR A:0x643420a8
y.create.l HWIO_DBACK_HS_CH7_PART1_DEC_DATA0_ADDR A:0x643420b4
y.create.l HWIO_DBACK_HS_CH8_PART1_DEC_DATA0_ADDR A:0x643420c0
y.create.l HWIO_DBACK_HS_CH9_PART1_DEC_DATA0_ADDR A:0x643420cc
y.create.l HWIO_DBACK_HS_CH0_PART1_DEC_STAT_ADDR A:0x64342064
y.create.l HWIO_DBACK_HS_CH1_PART1_DEC_STAT_ADDR A:0x64342070
y.create.l HWIO_DBACK_HS_CH2_PART1_DEC_STAT_ADDR A:0x6434207c
y.create.l HWIO_DBACK_HS_CH3_PART1_DEC_STAT_ADDR A:0x64342088
y.create.l HWIO_DBACK_HS_CH4_PART1_DEC_STAT_ADDR A:0x64342094
y.create.l HWIO_DBACK_HS_CH5_PART1_DEC_STAT_ADDR A:0x643420a0
y.create.l HWIO_DBACK_HS_CH6_PART1_DEC_STAT_ADDR A:0x643420ac
y.create.l HWIO_DBACK_HS_CH7_PART1_DEC_STAT_ADDR A:0x643420b8
y.create.l HWIO_DBACK_HS_CH8_PART1_DEC_STAT_ADDR A:0x643420c4
y.create.l HWIO_DBACK_HS_CH9_PART1_DEC_STAT_ADDR A:0x643420d0
y.create.l HWIO_DBACK_HS_CH0_SLOT1_AE_EST_ADDR A:0x64342068
y.create.l HWIO_DBACK_HS_CH1_SLOT1_AE_EST_ADDR A:0x64342074
y.create.l HWIO_DBACK_HS_CH2_SLOT1_AE_EST_ADDR A:0x64342080
y.create.l HWIO_DBACK_HS_CH3_SLOT1_AE_EST_ADDR A:0x6434208c
y.create.l HWIO_DBACK_HS_CH4_SLOT1_AE_EST_ADDR A:0x64342098
y.create.l HWIO_DBACK_HS_CH5_SLOT1_AE_EST_ADDR A:0x643420a4
y.create.l HWIO_DBACK_HS_CH6_SLOT1_AE_EST_ADDR A:0x643420b0
y.create.l HWIO_DBACK_HS_CH7_SLOT1_AE_EST_ADDR A:0x643420bc
y.create.l HWIO_DBACK_HS_CH8_SLOT1_AE_EST_ADDR A:0x643420c8
y.create.l HWIO_DBACK_HS_CH9_SLOT1_AE_EST_ADDR A:0x643420d4
y.create.l HWIO_DBACK_HS_CH0_PART2_DEC_DATA1_ADDR A:0x643420d8
y.create.l HWIO_DBACK_HS_CH1_PART2_DEC_DATA1_ADDR A:0x643420e8
y.create.l HWIO_DBACK_HS_CH2_PART2_DEC_DATA1_ADDR A:0x643420f8
y.create.l HWIO_DBACK_HS_CH3_PART2_DEC_DATA1_ADDR A:0x64342108
y.create.l HWIO_DBACK_HS_CH4_PART2_DEC_DATA1_ADDR A:0x64342118
y.create.l HWIO_DBACK_HS_CH5_PART2_DEC_DATA1_ADDR A:0x64342128
y.create.l HWIO_DBACK_HS_CH6_PART2_DEC_DATA1_ADDR A:0x64342138
y.create.l HWIO_DBACK_HS_CH7_PART2_DEC_DATA1_ADDR A:0x64342148
y.create.l HWIO_DBACK_HS_CH8_PART2_DEC_DATA1_ADDR A:0x64342158
y.create.l HWIO_DBACK_HS_CH9_PART2_DEC_DATA1_ADDR A:0x64342168
y.create.l HWIO_DBACK_HS_CH0_PART2_DEC_STAT_ADDR A:0x643420dc
y.create.l HWIO_DBACK_HS_CH1_PART2_DEC_STAT_ADDR A:0x643420ec
y.create.l HWIO_DBACK_HS_CH2_PART2_DEC_STAT_ADDR A:0x643420fc
y.create.l HWIO_DBACK_HS_CH3_PART2_DEC_STAT_ADDR A:0x6434210c
y.create.l HWIO_DBACK_HS_CH4_PART2_DEC_STAT_ADDR A:0x6434211c
y.create.l HWIO_DBACK_HS_CH5_PART2_DEC_STAT_ADDR A:0x6434212c
y.create.l HWIO_DBACK_HS_CH6_PART2_DEC_STAT_ADDR A:0x6434213c
y.create.l HWIO_DBACK_HS_CH7_PART2_DEC_STAT_ADDR A:0x6434214c
y.create.l HWIO_DBACK_HS_CH8_PART2_DEC_STAT_ADDR A:0x6434215c
y.create.l HWIO_DBACK_HS_CH9_PART2_DEC_STAT_ADDR A:0x6434216c
y.create.l HWIO_DBACK_HS_CH0_SLOT2_AE_EST_ADDR A:0x643420e0
y.create.l HWIO_DBACK_HS_CH1_SLOT2_AE_EST_ADDR A:0x643420f0
y.create.l HWIO_DBACK_HS_CH2_SLOT2_AE_EST_ADDR A:0x64342100
y.create.l HWIO_DBACK_HS_CH3_SLOT2_AE_EST_ADDR A:0x64342110
y.create.l HWIO_DBACK_HS_CH4_SLOT2_AE_EST_ADDR A:0x64342120
y.create.l HWIO_DBACK_HS_CH5_SLOT2_AE_EST_ADDR A:0x64342130
y.create.l HWIO_DBACK_HS_CH6_SLOT2_AE_EST_ADDR A:0x64342140
y.create.l HWIO_DBACK_HS_CH7_SLOT2_AE_EST_ADDR A:0x64342150
y.create.l HWIO_DBACK_HS_CH8_SLOT2_AE_EST_ADDR A:0x64342160
y.create.l HWIO_DBACK_HS_CH9_SLOT2_AE_EST_ADDR A:0x64342170
y.create.l HWIO_DBACK_HS_CH0_SLOT3_AE_EST_ADDR A:0x643420e4
y.create.l HWIO_DBACK_HS_CH1_SLOT3_AE_EST_ADDR A:0x643420f4
y.create.l HWIO_DBACK_HS_CH2_SLOT3_AE_EST_ADDR A:0x64342104
y.create.l HWIO_DBACK_HS_CH3_SLOT3_AE_EST_ADDR A:0x64342114
y.create.l HWIO_DBACK_HS_CH4_SLOT3_AE_EST_ADDR A:0x64342124
y.create.l HWIO_DBACK_HS_CH5_SLOT3_AE_EST_ADDR A:0x64342134
y.create.l HWIO_DBACK_HS_CH6_SLOT3_AE_EST_ADDR A:0x64342144
y.create.l HWIO_DBACK_HS_CH7_SLOT3_AE_EST_ADDR A:0x64342154
y.create.l HWIO_DBACK_HS_CH8_SLOT3_AE_EST_ADDR A:0x64342164
y.create.l HWIO_DBACK_HS_CH9_SLOT3_AE_EST_ADDR A:0x64342174
y.create.l HWIO_DBACK_EAGCH_DEC_DATA_ADDR A:0x64342178
y.create.l HWIO_DBACK_EAGCH_DEC_STAT_ADDR A:0x6434217c
y.create.l HWIO_DBACK_EAGCH_METRIC_ADDR A:0x64342180
y.create.l HWIO_DBACK_HSSCCH_CTL1_ADDR A:0x64342184
y.create.l HWIO_DBACK_HSSCCH_CTL2_ADDR A:0x64342188
y.create.l HWIO_HS_SCCH_PART2_DECODE_MAP_ADDR A:0x6434218c
y.create.l HWIO_DBACK_CH0_UEID_MASK_0_ADDR A:0x64342190
y.create.l HWIO_DBACK_CH1_UEID_MASK_0_ADDR A:0x64342194
y.create.l HWIO_DBACK_CH2_UEID_MASK_0_ADDR A:0x64342198
y.create.l HWIO_DBACK_CH3_UEID_MASK_0_ADDR A:0x6434219c
y.create.l HWIO_DBACK_CH4_UEID_MASK_0_ADDR A:0x643421a0
y.create.l HWIO_DBACK_CH5_UEID_MASK_0_ADDR A:0x643421a4
y.create.l HWIO_DBACK_CH6_UEID_MASK_0_ADDR A:0x643421a8
y.create.l HWIO_DBACK_CH7_UEID_MASK_0_ADDR A:0x643421ac
y.create.l HWIO_DBACK_CH8_UEID_MASK_0_ADDR A:0x643421b0
y.create.l HWIO_DBACK_CH9_UEID_MASK_0_ADDR A:0x643421b4
y.create.l HWIO_DBACK_CH0_UEID_MASK_1_ADDR A:0x643421b8
y.create.l HWIO_DBACK_CH1_UEID_MASK_1_ADDR A:0x643421bc
y.create.l HWIO_DBACK_CH2_UEID_MASK_1_ADDR A:0x643421c0
y.create.l HWIO_DBACK_CH3_UEID_MASK_1_ADDR A:0x643421c4
y.create.l HWIO_DBACK_CH4_UEID_MASK_1_ADDR A:0x643421c8
y.create.l HWIO_DBACK_CH5_UEID_MASK_1_ADDR A:0x643421cc
y.create.l HWIO_DBACK_CH6_UEID_MASK_1_ADDR A:0x643421d0
y.create.l HWIO_DBACK_CH7_UEID_MASK_1_ADDR A:0x643421d4
y.create.l HWIO_DBACK_CH8_UEID_MASK_1_ADDR A:0x643421d8
y.create.l HWIO_DBACK_CH9_UEID_MASK_1_ADDR A:0x643421dc
y.create.l HWIO_DBACK_HSSCCH_PART1_TRIGGER_ADDR A:0x643421e0
y.create.l HWIO_DBACK_HSSCCH_YAM_THRES_ADDR A:0x643421e4
y.create.l HWIO_DBACK_HSSCCH_PART2_TRIGGER_ADDR A:0x643421e8
y.create.l HWIO_DBACK_HSSCCH_STATUS_ADDR A:0x643421ec
y.create.l HWIO_DBACK_EAGCH_CONFIG_ADDR A:0x643421f0
y.create.l HWIO_DBACK_EAGCH_CTL_ADDR A:0x643421f4
y.create.l HWIO_DBACK_EAGCH_TRIGGER_ADDR A:0x643421f8
y.create.l HWIO_DBACK_EAGCH_RM_PATTERN_0_ADDR A:0x643421fc
y.create.l HWIO_DBACK_EAGCH_RM_PATTERN_1_ADDR A:0x64342200
y.create.l HWIO_DBACK_EAGCH_RM_PATTERN_2_ADDR A:0x64342204
y.create.l HWIO_DBACK_HS_EUL_CTL_CH_RST_ADDR A:0x64342208
y.create.l HWIO_DBACK_NONHS_WCB_SIZE_ADDR A:0x6434220c
y.create.l HWIO_DBACK_HS_WCB_SIZE_ADDR A:0x64342210
y.create.l HWIO_DBACK_PART1_INT_STATUS_ADDR A:0x64342214
y.create.l HWIO_DBACK_PART1_INT_CLR_ADDR A:0x64342218
y.create.l HWIO_DBACK_PART1_INT_EN_ADDR A:0x6434221c
y.create.l HWIO_DBACK_PART2_INT_STATUS_ADDR A:0x64342220
y.create.l HWIO_DBACK_PART2_INT_CLR_ADDR A:0x64342224
y.create.l HWIO_DBACK_PART2_INT_EN_ADDR A:0x64342228
y.create.l HWIO_DBACK_EAGCH_INT_EN_ADDR A:0x6434222c
y.create.l HWIO_DBACK_TEST_MEM_SEL_ADDR A:0x64342230
y.create.l HWIO_DBACK_TEST_BUS_SEL_ADDR A:0x64342234
y.create.l HWIO_DBACK_MEM_ADDR_ADDR A:0x64342238
y.create.l HWIO_DBACK_MEM_DATA0_ADDR A:0x6434223c
y.create.l HWIO_DBACK_MEM_DATA1_ADDR A:0x64342240
y.create.l HWIO_DBACK_MEM_DATA2_ADDR A:0x64342244
y.create.l HWIO_DBACK_MEM_DATA3_ADDR A:0x64342248
y.create.l HWIO_DBACK_MEM_DATA4_ADDR A:0x6434224c
y.create.l HWIO_T_DBACK_HS_CH0_DEC_DATA0_ADDR A:0x64342400
y.create.l HWIO_T_DBACK_HS_CH1_DEC_DATA0_ADDR A:0x6434240c
y.create.l HWIO_T_DBACK_HS_CH2_DEC_DATA0_ADDR A:0x64342418
y.create.l HWIO_T_DBACK_HS_CH3_DEC_DATA0_ADDR A:0x64342424
y.create.l HWIO_T_DBACK_HS_CH0_DEC_DATA1_ADDR A:0x64342404
y.create.l HWIO_T_DBACK_HS_CH1_DEC_DATA1_ADDR A:0x64342410
y.create.l HWIO_T_DBACK_HS_CH2_DEC_DATA1_ADDR A:0x6434241c
y.create.l HWIO_T_DBACK_HS_CH3_DEC_DATA1_ADDR A:0x64342428
y.create.l HWIO_T_DBACK_HS_CH0_DEC_STAT_ADDR A:0x64342408
y.create.l HWIO_T_DBACK_HS_CH1_DEC_STAT_ADDR A:0x64342414
y.create.l HWIO_T_DBACK_HS_CH2_DEC_STAT_ADDR A:0x64342420
y.create.l HWIO_T_DBACK_HS_CH3_DEC_STAT_ADDR A:0x6434242c
y.create.l HWIO_T_DBACK_EAGCH0_DEC_DATA0_ADDR A:0x64342430
y.create.l HWIO_T_DBACK_EAGCH1_DEC_DATA0_ADDR A:0x64342440
y.create.l HWIO_T_DBACK_EAGCH2_DEC_DATA0_ADDR A:0x64342450
y.create.l HWIO_T_DBACK_EAGCH3_DEC_DATA0_ADDR A:0x64342460
y.create.l HWIO_T_DBACK_EAGCH0_DEC_DATA1_ADDR A:0x64342434
y.create.l HWIO_T_DBACK_EAGCH1_DEC_DATA1_ADDR A:0x64342444
y.create.l HWIO_T_DBACK_EAGCH2_DEC_DATA1_ADDR A:0x64342454
y.create.l HWIO_T_DBACK_EAGCH3_DEC_DATA1_ADDR A:0x64342464
y.create.l HWIO_T_DBACK_EAGCH0_DEC_STAT_ADDR A:0x64342438
y.create.l HWIO_T_DBACK_EAGCH1_DEC_STAT_ADDR A:0x64342448
y.create.l HWIO_T_DBACK_EAGCH2_DEC_STAT_ADDR A:0x64342458
y.create.l HWIO_T_DBACK_EAGCH3_DEC_STAT_ADDR A:0x64342468
y.create.l HWIO_T_DBACK_EAGCH0_METRIC_ADDR A:0x6434243c
y.create.l HWIO_T_DBACK_EAGCH1_METRIC_ADDR A:0x6434244c
y.create.l HWIO_T_DBACK_EAGCH2_METRIC_ADDR A:0x6434245c
y.create.l HWIO_T_DBACK_EAGCH3_METRIC_ADDR A:0x6434246c
y.create.l HWIO_T_DBACK_FPACH_DEC_DATA0_ADDR A:0x64342470
y.create.l HWIO_T_DBACK_FPACH_DEC_DATA1_ADDR A:0x64342474
y.create.l HWIO_T_DBACK_FPACH_DEC_STAT_ADDR A:0x64342478
y.create.l HWIO_T_DBACK_TEST_MEM_SEL_ADDR A:0x6434247c
y.create.l HWIO_T_DBACK_TEST_BUS_SEL_ADDR A:0x64342480
y.create.l HWIO_T_DBACK_MEM_ADDR_ADDR A:0x64342484
y.create.l HWIO_T_DBACK_MEM_DATA0_ADDR A:0x64342488
y.create.l HWIO_T_DBACK_MEM_DATA1_ADDR A:0x6434248c
y.create.l HWIO_T_DBACK_MEM_DATA2_ADDR A:0x64342490
y.create.l HWIO_T_DBACK_MEM_DATA3_ADDR A:0x64342494
y.create.l HWIO_T_DBACK_MEM_DATA4_ADDR A:0x64342498
y.create.l HWIO_T_DBACK_HS_CH0_DC_DEC_DATA0_ADDR A:0x6434249c
y.create.l HWIO_T_DBACK_HS_CH1_DC_DEC_DATA0_ADDR A:0x643424a8
y.create.l HWIO_T_DBACK_HS_CH2_DC_DEC_DATA0_ADDR A:0x643424b4
y.create.l HWIO_T_DBACK_HS_CH3_DC_DEC_DATA0_ADDR A:0x643424c0
y.create.l HWIO_T_DBACK_HS_CH0_DC_DEC_DATA1_ADDR A:0x643424a0
y.create.l HWIO_T_DBACK_HS_CH1_DC_DEC_DATA1_ADDR A:0x643424ac
y.create.l HWIO_T_DBACK_HS_CH2_DC_DEC_DATA1_ADDR A:0x643424b8
y.create.l HWIO_T_DBACK_HS_CH3_DC_DEC_DATA1_ADDR A:0x643424c4
y.create.l HWIO_T_DBACK_HS_CH0_DC_DEC_STAT_ADDR A:0x643424a4
y.create.l HWIO_T_DBACK_HS_CH1_DC_DEC_STAT_ADDR A:0x643424b0
y.create.l HWIO_T_DBACK_HS_CH2_DC_DEC_STAT_ADDR A:0x643424bc
y.create.l HWIO_T_DBACK_HS_CH3_DC_DEC_STAT_ADDR A:0x643424c8
y.create.l HWIO_DINT_CFG_ADDR A:0x64342600
y.create.l HWIO_DINT_CH0_CFG_ADDR A:0x64342604
y.create.l HWIO_DINT_CH1_CFG_ADDR A:0x64342608
y.create.l HWIO_DINT_CH2_CFG_ADDR A:0x6434260c
y.create.l HWIO_TD_BLOCK_SIZE_ADDR A:0x64342614
y.create.l HWIO_TD_INTLV_CFG_LO_ADDR A:0x64342618
y.create.l HWIO_TD_INTLV_CFG_HI_ADDR A:0x6434261c
y.create.l HWIO_TD_INTLV_SIZE_LO_ADDR A:0x64342620
y.create.l HWIO_TD_PUNCT_LO_ADDR A:0x64342624
y.create.l HWIO_TD_PUNCT_HI_ADDR A:0x64342628
y.create.l HWIO_DINT_PKT_OFFSET_ADDR A:0x64342630
y.create.l HWIO_DINT_PKT_CFG_ADDR A:0x64342634
y.create.l HWIO_DINT_TASK_OFFSET_ADDR A:0x64342638
y.create.l HWIO_DINT_TASK_LIST_ADDR A:0x6434263c
y.create.l HWIO_TST_SYNC_DINT_ADDR A:0x64342640
y.create.l HWIO_TST_CH0_SYMS_ADDR A:0x64342644
y.create.l HWIO_TST_CH1_SYMS_ADDR A:0x64342648
y.create.l HWIO_TST_CH2_SYMS_ADDR A:0x6434264c
y.create.l HWIO_TST_SEL_DINT_ADDR A:0x64342654
y.create.l HWIO_DINT_OTD_CFG_ADDR A:0x64342658
y.create.l HWIO_TST_SYS_TIME_ADDR A:0x64342670
y.create.l HWIO_DEINT_DBG_BUS_CTL_ADDR A:0x64342674
y.create.l HWIO_DEC_CLR_INT_STATUS_ADDR A:0x64342684
y.create.l HWIO_DEINT_CLK_STATUS_ADDR A:0x64342688
y.create.l HWIO_DEC_DONE_INT_STATUS_ADDR A:0x6434268c
y.create.l HWIO_DEINT_TASK_STATUS_ADDR A:0x64342690
y.create.l HWIO_DEINT_FRMHYP_STATUS_ADDR A:0x64342694
y.create.l HWIO_DINT_VD_RD_ADDR_ADDR A:0x64342698
y.create.l HWIO_DINT_FCH_CFG0_ADDR A:0x6434269c
y.create.l HWIO_DINT_FCH_CFG1_ADDR A:0x643426a0
y.create.l HWIO_DINT_FCH_TRIGGER_ADDR A:0x643426a4
y.create.l HWIO_DINT_FCH_WR_BANK_ADDR A:0x643426a8
y.create.l HWIO_DINT_FCH_EGTH_HYP_CFG0_ADDR A:0x643426ac
y.create.l HWIO_DINT_FCH_EGTH_HYP_CFG1_ADDR A:0x643426b0
y.create.l HWIO_DINT_FCH_EGTH_HYP_CFG2_ADDR A:0x643426b4
y.create.l HWIO_DINT_FCH_EGTH_HYP_CFG3_ADDR A:0x643426b8
y.create.l HWIO_DINT_FCH_QRTR_HYP_CFG0_ADDR A:0x643426bc
y.create.l HWIO_DINT_FCH_QRTR_HYP_CFG1_ADDR A:0x643426c0
y.create.l HWIO_DINT_FCH_QRTR_HYP_CFG2_ADDR A:0x643426c4
y.create.l HWIO_DINT_FCH_QRTR_HYP_CFG3_ADDR A:0x643426c8
y.create.l HWIO_DINT_FCH_HALF_HYP_CFG0_ADDR A:0x643426cc
y.create.l HWIO_DINT_FCH_HALF_HYP_CFG1_ADDR A:0x643426d0
y.create.l HWIO_DINT_FCH_HALF_HYP_CFG2_ADDR A:0x643426d4
y.create.l HWIO_DINT_FCH_HALF_HYP_CFG3_ADDR A:0x643426d8
y.create.l HWIO_DINT_FCH_FULL_HYP_CFG0_ADDR A:0x643426dc
y.create.l HWIO_DINT_FCH_FULL_HYP_CFG1_ADDR A:0x643426e0
y.create.l HWIO_DINT_FCH_FULL_HYP_CFG2_ADDR A:0x643426e4
y.create.l HWIO_DINT_FCH_FULL_HYP_CFG3_ADDR A:0x643426e8
y.create.l HWIO_COMB_FUND_SOFT_DEC_IQ_WR_ADDR A:0x64342900
y.create.l HWIO_C_SYNC_TRIG_REG_ADDR A:0x64342904
y.create.l HWIO_CH0_Q_SOFTDEC_ENABLE_ADDR A:0x64342908
y.create.l HWIO_CH1_CONTROL_ADDR A:0x6434290c
y.create.l HWIO_CH2_CONTROL_ADDR A:0x64342910
y.create.l HWIO_CDMA_WIDGET_STATUS0_ADDR A:0x64342914
y.create.l HWIO_RESET_STATUS0_ADDR A:0x64342918
y.create.l HWIO_CDMA_WIDGET_STATUS1_ADDR A:0x6434291c
y.create.l HWIO_RESET_STATUS1_ADDR A:0x64342920
y.create.l HWIO_HDR_DINT_STATUS_ADDR A:0x64342c24
y.create.l HWIO_HDR_DINT_DBG_BUS_ADDR A:0x64342c80
y.create.l HWIO_HDR_DINT_CLK_STATUS_ADDR A:0x64342c84
y.create.l HWIO_DEMBACK_BUFF_MODE_ADDR A:0x64344004
y.create.l HWIO_DEMBACK_AHB_MEM_PAGE_ADDR A:0x64344008
y.create.l HWIO_DEMBACK_BUFF_MEM_CMD_ADDR A:0x64344010
y.create.l HWIO_DEMBACK_BUFF_MEM_WR_ADDR A:0x64344014
y.create.l HWIO_DEMBACK_BUFF_MEM_RD_ADDR A:0x64344018
y.create.l HWIO_DEMBACK_DBBUF_RDR0_CFG0_ADDR A:0x64344020
y.create.l HWIO_DEMBACK_DBBUF_RDR1_CFG0_ADDR A:0x6434402c
y.create.l HWIO_DEMBACK_DBBUF_RDR2_CFG0_ADDR A:0x64344038
y.create.l HWIO_DEMBACK_DBBUF_RDR3_CFG0_ADDR A:0x64344044
y.create.l HWIO_DEMBACK_DBBUF_RDR0_CFG1_ADDR A:0x64344024
y.create.l HWIO_DEMBACK_DBBUF_RDR1_CFG1_ADDR A:0x64344030
y.create.l HWIO_DEMBACK_DBBUF_RDR2_CFG1_ADDR A:0x6434403c
y.create.l HWIO_DEMBACK_DBBUF_RDR3_CFG1_ADDR A:0x64344048
y.create.l HWIO_DEMBACK_DBBUF_RDR0_XFER_CTL_ADDR A:0x64344028
y.create.l HWIO_DEMBACK_DBBUF_RDR1_XFER_CTL_ADDR A:0x64344034
y.create.l HWIO_DEMBACK_DBBUF_RDR2_XFER_CTL_ADDR A:0x64344040
y.create.l HWIO_DEMBACK_DBBUF_RDR3_XFER_CTL_ADDR A:0x6434404c
y.create.l HWIO_DEMBACK_DBBUF_WRTR0_CFG0_ADDR A:0x64344080
y.create.l HWIO_DEMBACK_DBBUF_WRTR1_CFG0_ADDR A:0x6434408c
y.create.l HWIO_DEMBACK_DBBUF_WRTR2_CFG0_ADDR A:0x64344098
y.create.l HWIO_DEMBACK_DBBUF_WRTR3_CFG0_ADDR A:0x643440a4
y.create.l HWIO_DEMBACK_DBBUF_WRTR0_CFG1_ADDR A:0x64344084
y.create.l HWIO_DEMBACK_DBBUF_WRTR1_CFG1_ADDR A:0x64344090
y.create.l HWIO_DEMBACK_DBBUF_WRTR2_CFG1_ADDR A:0x6434409c
y.create.l HWIO_DEMBACK_DBBUF_WRTR3_CFG1_ADDR A:0x643440a8
y.create.l HWIO_DEMBACK_DBBUF_WRTR0_XFER_CTL_ADDR A:0x64344088
y.create.l HWIO_DEMBACK_DBBUF_WRTR1_XFER_CTL_ADDR A:0x64344094
y.create.l HWIO_DEMBACK_DBBUF_WRTR2_XFER_CTL_ADDR A:0x643440a0
y.create.l HWIO_DEMBACK_DBBUF_WRTR3_XFER_CTL_ADDR A:0x643440ac
y.create.l HWIO_DEMBACK_DBBUF_BRDG_CTL_ADDR A:0x64344100
y.create.l HWIO_DEMBACK_DBBUF_BRDG_STATUS_ADDR A:0x64344104
y.create.l HWIO_DEMBACK_DBBUF_BRDG_CLEAR_ADDR A:0x64344108
y.create.l HWIO_DEMBACK_BUFF_TBVD_DECOB_RD_MIN_ADDR A:0x64345000
y.create.l HWIO_DEMBACK_BUFF_TBVD_DECOB_RD_MAX_ADDR A:0x6434577c
y.create.l HWIO_DEMBACK_BUFF_SVD_DECOB_RD_MIN_ADDR A:0x64346000
y.create.l HWIO_DEMBACK_BUFF_SVD_DECOB_RD_MAX_ADDR A:0x64346d7c
y.create.l HWIO_SVD_TBVD_CLK_STATUS_REG_ADDR A:0x64348000
y.create.l HWIO_SVD_TBVD_HW_IDLE_ADDR A:0x64348004
y.create.l HWIO_SVD_TBVD_TESTBUS_ENABLE_ADDR A:0x64348008
y.create.l HWIO_SVD_MODE_ADDR A:0x6434800c
y.create.l HWIO_SVD_POLY2IJ_ADDR A:0x64348010
y.create.l HWIO_SVD_POLY3IJ_ADDR A:0x64348014
y.create.l HWIO_SVD_POLY3K_ADDR A:0x64348018
y.create.l HWIO_SVD_POLY4IJ_ADDR A:0x6434801c
y.create.l HWIO_SVD_POLY4KL_ADDR A:0x64348020
y.create.l HWIO_SVD_TESTCON_ADDR A:0x64348024
y.create.l HWIO_SVD_TESTOUT_ADDR A:0x64348028
y.create.l HWIO_SVD_TEST_MEM_SEL_ADDR A:0x6434802c
y.create.l HWIO_SVD_TEST_MEM_ADDR_ADDR A:0x64348030
y.create.l HWIO_SVD_TEST_MEM_WRITE_ADDR A:0x64348034
y.create.l HWIO_SVD_TEST_MEM_READ0_ADDR A:0x64348038
y.create.l HWIO_SVD_TEST_MEM_READ1_ADDR A:0x6434803c
y.create.l HWIO_SVD_TEST_MEM_DIN_ADDR A:0x64348040
y.create.l HWIO_TBVD_DEBUG_MEM_CMD_ADDR A:0x64348044
y.create.l HWIO_TBVD_DEBUG_MEM_WR_ADDR A:0x64348048
y.create.l HWIO_TBVD_DEBUG_MEM_RD_ADDR A:0x6434804c
y.create.l HWIO_LTE_DEMBACK_SCH_STATUS_WORD0_ADDR A:0x64349000
y.create.l HWIO_LTE_DEMBACK_SCH_SHARED_WORD0_ADDR A:0x64349100
y.create.l HWIO_LTE_DEMBACK_SCH_SHARED_WORD1_ADDR A:0x64349104
y.create.l HWIO_LTE_DEMBACK_SCH_SHARED_WORD2_ADDR A:0x64349108
y.create.l HWIO_LTE_DEMBACK_SCH_SHARED_WORD3_ADDR A:0x6434910c
y.create.l HWIO_LTE_DEMBACK_SCH_SHARED_WORD4_ADDR A:0x64349110
y.create.l HWIO_LTE_DEMBACK_SCH_SHARED_WORD5_ADDR A:0x64349114
y.create.l HWIO_PDSCH_HARQ_CFG_WORD0_ADDR A:0x64349200
y.create.l HWIO_PDSCH_HARQ_CFG_WORD1_ADDR A:0x64349204
y.create.l HWIO_PDSCH_HARQ_CFG_WORD2_ADDR A:0x64349208
y.create.l HWIO_PDSCH_HARQ_CFG_WORD3_ADDR A:0x6434920c
y.create.l HWIO_PDSCH_HARQ_CFG_WORD4_ADDR A:0x64349210
y.create.l HWIO_PDSCH_HARQ_CFG_WORD5_ADDR A:0x64349214
y.create.l HWIO_PDSCH_HARQ_CFG_WORD6_ADDR A:0x64349218
y.create.l HWIO_PDSCH_HARQ_CFG_WORD7_ADDR A:0x6434921c
y.create.l HWIO_PDSCH_HARQ_CFG_WORD8_ADDR A:0x64349220
y.create.l HWIO_LTE_DEMBACK_CCH_STATUS_WORD0_ADDR A:0x6434a000
y.create.l HWIO_LTE_DEMBACK_CCH_SHARED_WORD0_ADDR A:0x6434a100
y.create.l HWIO_LTE_DEMBACK_CCH_SHARED_WORD1_ADDR A:0x6434a104
y.create.l HWIO_LTE_DEMBACK_CCH_SHARED_WORD2_ADDR A:0x6434a108
y.create.l HWIO_LTE_DEMBACK_CCH_SHARED_WORD3_ADDR A:0x6434a10c
y.create.l HWIO_LTE_DEMBACK_CCH_SHARED_WORD4_ADDR A:0x6434a110
y.create.l HWIO_LTE_DEMBACK_CCH_SHARED_WORD5_ADDR A:0x6434a114
y.create.l HWIO_LTE_DEMBACK_CCH_SHARED_WORD6_ADDR A:0x6434a118
y.create.l HWIO_LTE_DEMBACK_CCH_SHARED_WORD7_ADDR A:0x6434a11c
y.create.l HWIO_PDCCH_DEINT_CFG_WORD0_ADDR A:0x6434a200
y.create.l HWIO_PDCCH_DEINT_CFG_WORD1_ADDR A:0x6434a204
y.create.l HWIO_PDCCH_DEINT_CFG_WORD2_ADDR A:0x6434a208
y.create.l HWIO_SYMBOL0_REG_MAP_0_WORD0_ADDR A:0x6434a300
y.create.l HWIO_SYMBOL0_REG_MAP_0_WORD1_ADDR A:0x6434a304
y.create.l HWIO_SYMBOL0_REG_MAP_0_WORD2_ADDR A:0x6434a308
y.create.l HWIO_SYMBOL0_REG_MAP_0_WORD3_ADDR A:0x6434a30c
y.create.l HWIO_SYMBOL0_REG_MAP_0_WORD4_ADDR A:0x6434a310
y.create.l HWIO_SYMBOL0_REG_MAP_0_WORD5_ADDR A:0x6434a314
y.create.l HWIO_SYMBOL0_REG_MAP_0_WORD6_ADDR A:0x6434a318
y.create.l HWIO_SYMBOL0_REG_MAP_0_WORD7_ADDR A:0x6434a31c
y.create.l HWIO_SYMBOL0_REG_MAP_1_WORD0_ADDR A:0x6434a400
y.create.l HWIO_SYMBOL0_REG_MAP_1_WORD1_ADDR A:0x6434a404
y.create.l HWIO_SYMBOL0_REG_MAP_1_WORD2_ADDR A:0x6434a408
y.create.l HWIO_SYMBOL0_REG_MAP_1_WORD3_ADDR A:0x6434a40c
y.create.l HWIO_SYMBOL0_REG_MAP_1_WORD4_ADDR A:0x6434a410
y.create.l HWIO_SYMBOL0_REG_MAP_1_WORD5_ADDR A:0x6434a414
y.create.l HWIO_SYMBOL0_REG_MAP_1_WORD6_ADDR A:0x6434a418
y.create.l HWIO_SYMBOL0_REG_MAP_1_WORD7_ADDR A:0x6434a41c
y.create.l HWIO_SYMBOL0_REG_MAP_2_WORD0_ADDR A:0x6434a500
y.create.l HWIO_SYMBOL0_REG_MAP_2_WORD1_ADDR A:0x6434a504
y.create.l HWIO_SYMBOL0_REG_MAP_2_WORD2_ADDR A:0x6434a508
y.create.l HWIO_SYMBOL0_REG_MAP_2_WORD3_ADDR A:0x6434a50c
y.create.l HWIO_SYMBOL0_REG_MAP_2_WORD4_ADDR A:0x6434a510
y.create.l HWIO_SYMBOL0_REG_MAP_2_WORD5_ADDR A:0x6434a514
y.create.l HWIO_SYMBOL0_REG_MAP_2_WORD6_ADDR A:0x6434a518
y.create.l HWIO_SYMBOL0_REG_MAP_2_WORD7_ADDR A:0x6434a51c
y.create.l HWIO_SYMBOL1_REG_MAP_0_WORD0_ADDR A:0x6434a600
y.create.l HWIO_SYMBOL1_REG_MAP_0_WORD1_ADDR A:0x6434a604
y.create.l HWIO_SYMBOL1_REG_MAP_0_WORD2_ADDR A:0x6434a608
y.create.l HWIO_SYMBOL1_REG_MAP_0_WORD3_ADDR A:0x6434a60c
y.create.l HWIO_SYMBOL1_REG_MAP_0_WORD4_ADDR A:0x6434a610
y.create.l HWIO_SYMBOL1_REG_MAP_0_WORD5_ADDR A:0x6434a614
y.create.l HWIO_SYMBOL1_REG_MAP_0_WORD6_ADDR A:0x6434a618
y.create.l HWIO_SYMBOL1_REG_MAP_0_WORD7_ADDR A:0x6434a61c
y.create.l HWIO_SYMBOL1_REG_MAP_0_WORD8_ADDR A:0x6434a620
y.create.l HWIO_SYMBOL1_REG_MAP_0_WORD9_ADDR A:0x6434a624
y.create.l HWIO_SYMBOL1_REG_MAP_0_WORD10_ADDR A:0x6434a628
y.create.l HWIO_SYMBOL1_REG_MAP_1_WORD0_ADDR A:0x6434a700
y.create.l HWIO_SYMBOL1_REG_MAP_1_WORD1_ADDR A:0x6434a704
y.create.l HWIO_SYMBOL1_REG_MAP_1_WORD2_ADDR A:0x6434a708
y.create.l HWIO_SYMBOL1_REG_MAP_1_WORD3_ADDR A:0x6434a70c
y.create.l HWIO_SYMBOL1_REG_MAP_1_WORD4_ADDR A:0x6434a710
y.create.l HWIO_SYMBOL1_REG_MAP_1_WORD5_ADDR A:0x6434a714
y.create.l HWIO_SYMBOL1_REG_MAP_1_WORD6_ADDR A:0x6434a718
y.create.l HWIO_SYMBOL1_REG_MAP_1_WORD7_ADDR A:0x6434a71c
y.create.l HWIO_SYMBOL1_REG_MAP_1_WORD8_ADDR A:0x6434a720
y.create.l HWIO_SYMBOL1_REG_MAP_1_WORD9_ADDR A:0x6434a724
y.create.l HWIO_SYMBOL1_REG_MAP_1_WORD10_ADDR A:0x6434a728
y.create.l HWIO_SYMBOL2_REG_MAP_WORD0_ADDR A:0x6434a800
y.create.l HWIO_SYMBOL2_REG_MAP_WORD1_ADDR A:0x6434a804
y.create.l HWIO_SYMBOL2_REG_MAP_WORD2_ADDR A:0x6434a808
y.create.l HWIO_SYMBOL2_REG_MAP_WORD3_ADDR A:0x6434a80c
y.create.l HWIO_SYMBOL2_REG_MAP_WORD4_ADDR A:0x6434a810
y.create.l HWIO_SYMBOL2_REG_MAP_WORD5_ADDR A:0x6434a814
y.create.l HWIO_SYMBOL2_REG_MAP_WORD6_ADDR A:0x6434a818
y.create.l HWIO_SYMBOL2_REG_MAP_WORD7_ADDR A:0x6434a81c
y.create.l HWIO_SYMBOL2_REG_MAP_WORD8_ADDR A:0x6434a820
y.create.l HWIO_SYMBOL2_REG_MAP_WORD9_ADDR A:0x6434a824
y.create.l HWIO_SYMBOL2_REG_MAP_WORD10_ADDR A:0x6434a828
y.create.l HWIO_PBCH_DEINT_CFG_WORD0_ADDR A:0x6434a900
y.create.l HWIO_PBCH_DEINT_CFG_WORD1_ADDR A:0x6434a904
y.create.l HWIO_PBCH_DEINT_CFG_WORD2_ADDR A:0x6434a908
y.create.l HWIO_PBCH_DEINT_CFG_WORD3_ADDR A:0x6434a90c
y.create.l HWIO_PBCH_DEINT_CFG_WORD4_ADDR A:0x6434a910
y.create.l HWIO_PBCH_DEINT_CFG_WORD5_ADDR A:0x6434a914
y.create.l HWIO_PBCH_DEINT_CFG_WORD6_ADDR A:0x6434a918
y.create.l HWIO_PBCH_DEINT_CFG_WORD7_ADDR A:0x6434a91c
y.create.l HWIO_PBCH_DEINT_CFG_WORD8_ADDR A:0x6434a920
y.create.l HWIO_PBCH_DEINT_CFG_WORD9_ADDR A:0x6434a924
y.create.l HWIO_PBCH_DEINT_CFG_WORD10_ADDR A:0x6434a928
y.create.l HWIO_PDCCH_REG_REORDER_WORD0_ADDR A:0x6434aa00
y.create.l HWIO_PDCCH_REG_REORDER_WORD1_ADDR A:0x6434aa04
y.create.l HWIO_PDCCH_REG_REORDER_WORD2_ADDR A:0x6434aa08
y.create.l HWIO_PDCCH_REG_REORDER_WORD3_ADDR A:0x6434aa0c
y.create.l HWIO_PDCCH_REG_REORDER_WORD4_ADDR A:0x6434aa10
y.create.l HWIO_PBCH_FOH_WORD0_ADDR A:0x6434ab00
y.create.l HWIO_PBCH_FOH_WORD1_ADDR A:0x6434ab04
y.create.l HWIO_PBCH_FOH_WORD2_ADDR A:0x6434ab08
y.create.l HWIO_PDSCH_REENC_TB_CFG_WORD0_ADDR A:0x6434b100
y.create.l HWIO_PDSCH_REENC_TB_CFG_WORD1_ADDR A:0x6434b104
y.create.l HWIO_PDSCH_REENC_TB_CFG_WORD2_ADDR A:0x6434b108
y.create.l HWIO_PDSCH_REENC_CB_WORD0_ADDR A:0x6434b200
y.create.l HWIO_PDSCH_REENC_CB_WORD1_ADDR A:0x6434b204
y.create.l HWIO_PDSCH_REENC_CB_WORD2_ADDR A:0x6434b208
y.create.l HWIO_PBCH_REENC_WORD0_ADDR A:0x6434b300
y.create.l HWIO_PBCH_REENC_WORD1_ADDR A:0x6434b304
y.create.l HWIO_PBCH_REENC_WORD2_ADDR A:0x6434b308
y.create.l HWIO_W_DBACK_HS_SHARED_WORD0_ADDR A:0x6434c100
y.create.l HWIO_W_DBACK_HS_SHARED_WORD1_ADDR A:0x6434c104
y.create.l HWIO_W_DBACK_HS_SHARED_WORD2_ADDR A:0x6434c108
y.create.l HWIO_W_DBACK_HS_SHARED_WORD3_ADDR A:0x6434c10c
y.create.l HWIO_W_DBACK_HS_SHARED_WORD4_ADDR A:0x6434c110
y.create.l HWIO_W_DBACK_HS_SHARED_WORD5_ADDR A:0x6434c114
y.create.l HWIO_W_DBACK_HS_SHARED_WORD6_ADDR A:0x6434c118
y.create.l HWIO_W_DBACK_HS_SHARED_WORD7_ADDR A:0x6434c11c
y.create.l HWIO_W_DBACK_HS_SHARED_WORD8_ADDR A:0x6434c120
y.create.l HWIO_W_DBACK_HS_SHARED_WORD9_ADDR A:0x6434c124
y.create.l HWIO_W_DBACK_HS_SHARED_WORD10_ADDR A:0x6434c128
y.create.l HWIO_W_DBACK_HS_SHARED_WORD11_ADDR A:0x6434c12c
y.create.l HWIO_W_DBACK_HS_SHARED_WORD12_ADDR A:0x6434c130
y.create.l HWIO_W_DBACK_HS_SHARED_WORD13_ADDR A:0x6434c134
y.create.l HWIO_W_DBACK_HS_SHARED_WORD14_ADDR A:0x6434c138
y.create.l HWIO_W_DBACK_HS_SHARED_WORD15_ADDR A:0x6434c13c
y.create.l HWIO_W_DBACK_HS_SHARED_WORD16_ADDR A:0x6434c140
y.create.l HWIO_W_DBACK_HS_SHARED_WORD17_ADDR A:0x6434c144
y.create.l HWIO_W_DBACK_HS_SHARED_WORD18_ADDR A:0x6434c148
y.create.l HWIO_W_DBACK_HS_SHARED_WORD19_ADDR A:0x6434c14c
y.create.l HWIO_W_DBACK_HS_SHARED_WORD20_ADDR A:0x6434c150
y.create.l HWIO_W_DBACK_HS_SHARED_WORD21_ADDR A:0x6434c154
y.create.l HWIO_W_DBACK_HS_SHARED_WORD22_ADDR A:0x6434c158
y.create.l HWIO_W_DBACK_HS_SHARED_WORD23_ADDR A:0x6434c15c
y.create.l HWIO_W_DBACK_HS_SHARED_WORD24_ADDR A:0x6434c160
y.create.l HWIO_W_DBACK_HS_SHARED_WORD25_ADDR A:0x6434c164
y.create.l HWIO_W_DBACK_HS_SHARED_WORD26_ADDR A:0x6434c168
y.create.l HWIO_W_DBACK_HS_SHARED_WORD27_ADDR A:0x6434c16c
y.create.l HWIO_W_DBACK_HS_SHARED_WORD28_ADDR A:0x6434c170
y.create.l HWIO_W_DBACK_HS_SHARED_WORD29_ADDR A:0x6434c174
y.create.l HWIO_W_DBACK_HS_SHARED_WORD30_ADDR A:0x6434c178
y.create.l HWIO_W_DBACK_HS_SHARED_WORD31_ADDR A:0x6434c17c
y.create.l HWIO_W_DBACK_HS_SHARED_WORD32_ADDR A:0x6434c180
y.create.l HWIO_W_DBACK_HS_SHARED_WORD33_ADDR A:0x6434c184
y.create.l HWIO_W_DBACK_HS_SHARED_WORD34_ADDR A:0x6434c188
y.create.l HWIO_W_DBACK_HS_SHARED_WORD35_ADDR A:0x6434c18c
y.create.l HWIO_W_DBACK_HS_SHARED_WORD36_ADDR A:0x6434c190
y.create.l HWIO_W_DBACK_HS_SHARED_WORD37_ADDR A:0x6434c194
y.create.l HWIO_W_DBACK_HS_SHARED_WORD38_ADDR A:0x6434c198
y.create.l HWIO_W_DBACK_HS_SHARED_WORD39_ADDR A:0x6434c19c
y.create.l HWIO_W_DBACK_HS_SHARED_WORD40_ADDR A:0x6434c1a0
y.create.l HWIO_W_DBACK_HS_SHARED_WORD41_ADDR A:0x6434c1a4
y.create.l HWIO_W_DBACK_HS_SHARED_WORD42_ADDR A:0x6434c1a8
y.create.l HWIO_W_DBACK_HS_SHARED_WORD43_ADDR A:0x6434c1ac
y.create.l HWIO_W_DBACK_HS_SHARED_WORD44_ADDR A:0x6434c1b0
y.create.l HWIO_W_DBACK_HS_SHARED_WORD45_ADDR A:0x6434c1b4
y.create.l HWIO_W_DBACK_HS_SHARED_WORD46_ADDR A:0x6434c1b8
y.create.l HWIO_W_DBACK_HS_SHARED_WORD47_ADDR A:0x6434c1bc
y.create.l HWIO_W_DBACK_HS_SHARED_WORD48_ADDR A:0x6434c1c0
y.create.l HWIO_W_DBACK_HS_SHARED_WORD49_ADDR A:0x6434c1c4
y.create.l HWIO_W_DBACK_HS_SHARED_WORD50_ADDR A:0x6434c1c8
y.create.l HWIO_W_DBACK_HS_SHARED_WORD51_ADDR A:0x6434c1cc
y.create.l HWIO_W_DBACK_HS_SHARED_WORD52_ADDR A:0x6434c1d0
y.create.l HWIO_W_DBACK_HS_SHARED_WORD53_ADDR A:0x6434c1d4
y.create.l HWIO_W_DBACK_HS_SHARED_WORD54_ADDR A:0x6434c1d8
y.create.l HWIO_W_DBACK_HS_SHARED_WORD55_ADDR A:0x6434c1dc
y.create.l HWIO_W_DBACK_HS_SHARED_WORD56_ADDR A:0x6434c1e0
y.create.l HWIO_W_DBACK_HS_SHARED_WORD57_ADDR A:0x6434c1e4
y.create.l HWIO_W_DBACK_HS_TD_DECIB_WRITER_WORD0_ADDR A:0x6434c200
y.create.l HWIO_W_DBACK_HS_TD_DECIB_WRITER_CFG_WORD0_ADDR A:0x6434c300
y.create.l HWIO_W_DBACK_HS_TD_DECIB_WRITER_CFG_WORD1_ADDR A:0x6434c304
y.create.l HWIO_W_DBACK_HS_TD_DECIB_WRITER_CFG_WORD2_ADDR A:0x6434c308
y.create.l HWIO_W_DBACK_HS_TD_DECIB_WRITER_CFG_WORD3_ADDR A:0x6434c30c
y.create.l HWIO_W_DBACK_HS_TD_DECIB_WRITER_CFG_WORD4_ADDR A:0x6434c310
y.create.l HWIO_W_DBACK_HS_TD_DECIB_WRITER_CFG_WORD5_ADDR A:0x6434c314
y.create.l HWIO_W_DBACK_HS_TD_DECIB_WRITER_CFG_WORD6_ADDR A:0x6434c318
y.create.l HWIO_W_DBACK_HS_TD_DECIB_WRITER_CFG_WORD7_ADDR A:0x6434c31c
y.create.l HWIO_W_DBACK_NONHS_SHARED_WORD0_ADDR A:0x6434d100
y.create.l HWIO_W_DBACK_NONHS_SHARED_WORD1_ADDR A:0x6434d104
y.create.l HWIO_W_DBACK_NONHS_SHARED_WORD2_ADDR A:0x6434d108
y.create.l HWIO_W_DBACK_NONHS_SHARED_WORD3_ADDR A:0x6434d10c
y.create.l HWIO_W_DBACK_NONHS_SHARED_WORD4_ADDR A:0x6434d110
y.create.l HWIO_W_DBACK_NONHS_SHARED_WORD5_ADDR A:0x6434d114
y.create.l HWIO_W_DBACK_NONHS_SHARED_WORD6_ADDR A:0x6434d118
y.create.l HWIO_W_DBACK_NONHS_SHARED_WORD7_ADDR A:0x6434d11c
y.create.l HWIO_W_DBACK_NONHS_DRM_CFG_WORD0_ADDR A:0x6434d200
y.create.l HWIO_W_DBACK_NONHS_DRM_CFG_WORD1_ADDR A:0x6434d204
y.create.l HWIO_W_DBACK_NONHS_DRM_CFG_WORD2_ADDR A:0x6434d208
y.create.l HWIO_W_DBACK_NONHS_DRM_CFG_WORD3_ADDR A:0x6434d20c
y.create.l HWIO_W_DBACK_NONHS_DRM_CFG_WORD4_ADDR A:0x6434d210
y.create.l HWIO_W_DBACK_NONHS_DRM_CFG_WORD5_ADDR A:0x6434d214
y.create.l HWIO_W_DBACK_NONHS_DRM_CFG_WORD6_ADDR A:0x6434d218
y.create.l HWIO_W_DBACK_NONHS_DRM_CFG_WORD7_ADDR A:0x6434d21c
y.create.l HWIO_W_DBACK_NONHS_DRM_CFG_WORD8_ADDR A:0x6434d220
y.create.l HWIO_W_DBACK_NONHS_DRM_CFG_WORD9_ADDR A:0x6434d224
y.create.l HWIO_W_DBACK_NONHS_DRM_CFG_WORD10_ADDR A:0x6434d228
y.create.l HWIO_W_DBACK_NONHS_DRM_CFG_WORD11_ADDR A:0x6434d22c
y.create.l HWIO_W_DBACK_NONHS_DRM_CFG_WORD12_ADDR A:0x6434d230
y.create.l HWIO_W_DBACK_NONHS_DRM_CFG_WORD13_ADDR A:0x6434d234
y.create.l HWIO_W_DBACK_NONHS_DRM_CFG_WORD14_ADDR A:0x6434d238
y.create.l HWIO_W_DBACK_NONHS_DRM_CFG_WORD15_ADDR A:0x6434d23c
y.create.l HWIO_W_DBACK_NONHS_TD_DECIB_WRITER_CFG_WORD0_ADDR A:0x6434d300
y.create.l HWIO_W_DBACK_NONHS_TD_DECIB_WRITER_CFG_WORD1_ADDR A:0x6434d304
y.create.l HWIO_T_DBACK_SHARED_WORD0_ADDR A:0x6434e100
y.create.l HWIO_T_DBACK_SHARED_WORD1_ADDR A:0x6434e104
y.create.l HWIO_T_DBACK_SHARED_WORD2_ADDR A:0x6434e108
y.create.l HWIO_T_DBACK_SHARED_WORD3_ADDR A:0x6434e10c
y.create.l HWIO_T_DBACK_SHARED_WORD4_ADDR A:0x6434e110
y.create.l HWIO_T_DBACK_SHARED_WORD5_ADDR A:0x6434e114
y.create.l HWIO_T_DBACK_SHARED_WORD6_ADDR A:0x6434e118
y.create.l HWIO_T_DBACK_SHARED_WORD7_ADDR A:0x6434e11c
y.create.l HWIO_T_DBACK_SHARED_WORD8_ADDR A:0x6434e120
y.create.l HWIO_T_DBACK_SHARED_WORD9_ADDR A:0x6434e124
y.create.l HWIO_T_DBACK_SHARED_WORD10_ADDR A:0x6434e128
y.create.l HWIO_T_DBACK_SHARED_WORD11_ADDR A:0x6434e12c
y.create.l HWIO_T_DBACK_SHARED_WORD12_ADDR A:0x6434e130
y.create.l HWIO_T_DBACK_SHARED_WORD13_ADDR A:0x6434e134
y.create.l HWIO_T_DBACK_SHARED_WORD14_ADDR A:0x6434e138
y.create.l HWIO_T_DBACK_SHARED_WORD15_ADDR A:0x6434e13c
y.create.l HWIO_T_DBACK_SHARED_WORD16_ADDR A:0x6434e140
y.create.l HWIO_T_DBACK_SHARED_WORD17_ADDR A:0x6434e144
y.create.l HWIO_T_DBACK_SHARED_WORD18_ADDR A:0x6434e148
y.create.l HWIO_T_DBACK_SHARED_WORD19_ADDR A:0x6434e14c
y.create.l HWIO_T_DBACK_SHARED_WORD20_ADDR A:0x6434e150
y.create.l HWIO_T_DBACK_SHARED_WORD21_ADDR A:0x6434e154
y.create.l HWIO_T_DBACK_SHARED_WORD22_ADDR A:0x6434e158
y.create.l HWIO_T_DBACK_SHARED_WORD23_ADDR A:0x6434e15c
y.create.l HWIO_T_DBACK_SHARED_WORD24_ADDR A:0x6434e160
y.create.l HWIO_T_DBACK_SHARED_WORD25_ADDR A:0x6434e164
y.create.l HWIO_T_DBACK_SHARED_WORD26_ADDR A:0x6434e168
y.create.l HWIO_T_DBACK_SHARED_WORD27_ADDR A:0x6434e16c
y.create.l HWIO_T_DBACK_SHARED_WORD28_ADDR A:0x6434e170
y.create.l HWIO_T_DBACK_SHARED_WORD29_ADDR A:0x6434e174
y.create.l HWIO_T_DBACK_SHARED_WORD30_ADDR A:0x6434e178
y.create.l HWIO_T_DBACK_SHARED_WORD31_ADDR A:0x6434e17c
y.create.l HWIO_T_DBACK_SHARED_WORD32_ADDR A:0x6434e180
y.create.l HWIO_T_DBACK_SHARED_WORD33_ADDR A:0x6434e184
y.create.l HWIO_T_DBACK_SHARED_WORD34_ADDR A:0x6434e188
y.create.l HWIO_T_DBACK_SHARED_WORD35_ADDR A:0x6434e18c
y.create.l HWIO_T_DBACK_SHARED_WORD36_ADDR A:0x6434e190
y.create.l HWIO_T_DBACK_SHARED_WORD37_ADDR A:0x6434e194
y.create.l HWIO_T_DBACK_SHARED_WORD38_ADDR A:0x6434e198
y.create.l HWIO_T_DBACK_NONHS_DRM_CFG_WORD0_ADDR A:0x6434e200
y.create.l HWIO_T_DBACK_NONHS_DRM_CFG_WORD1_ADDR A:0x6434e204
y.create.l HWIO_T_DBACK_NONHS_DRM_CFG_WORD2_ADDR A:0x6434e208
y.create.l HWIO_T_DBACK_NONHS_DRM_CFG_WORD3_ADDR A:0x6434e20c
y.create.l HWIO_T_DBACK_NONHS_DRM_CFG_WORD4_ADDR A:0x6434e210
y.create.l HWIO_T_DBACK_NONHS_DRM_CFG_WORD5_ADDR A:0x6434e214
y.create.l HWIO_T_DBACK_NONHS_DRM_CFG_WORD6_ADDR A:0x6434e218
y.create.l HWIO_T_DBACK_NONHS_DRM_CFG_WORD7_ADDR A:0x6434e21c
y.create.l HWIO_T_DBACK_NONHS_DRM_CFG_WORD8_ADDR A:0x6434e220
y.create.l HWIO_T_DBACK_NONHS_DRM_CFG_WORD9_ADDR A:0x6434e224
y.create.l HWIO_T_DBACK_NONHS_DRM_CFG_WORD10_ADDR A:0x6434e228
y.create.l HWIO_T_DBACK_NONHS_DRM_CFG_WORD11_ADDR A:0x6434e22c
y.create.l HWIO_T_DBACK_NONHS_DRM_CFG_WORD12_ADDR A:0x6434e230
y.create.l HWIO_T_DBACK_NONHS_DRM_CFG_WORD13_ADDR A:0x6434e234
y.create.l HWIO_T_DBACK_NONHS_DRM_CFG_WORD14_ADDR A:0x6434e238
y.create.l HWIO_T_DBACK_NONHS_DRM_CFG_WORD15_ADDR A:0x6434e23c
y.create.l HWIO_T_DBACK_NONHS_DRM_CFG_WORD16_ADDR A:0x6434e240
y.create.l HWIO_T_DBACK_NONHS_DRM_CFG_WORD17_ADDR A:0x6434e244
y.create.l HWIO_T_DBACK_NONHS_DRM_CFG_WORD18_ADDR A:0x6434e248
y.create.l HWIO_T_DBACK_NONHS_DRM_CFG_WORD19_ADDR A:0x6434e24c
y.create.l HWIO_T_DBACK_NONHS_DRM_CFG_WORD20_ADDR A:0x6434e250
y.create.l HWIO_T_DBACK_NONHS_DRM_CFG_WORD21_ADDR A:0x6434e254
y.create.l HWIO_T_DBACK_NONHS_DRM_CFG_WORD22_ADDR A:0x6434e258
y.create.l HWIO_T_DBACK_NONHS_DRM_CFG_WORD23_ADDR A:0x6434e25c
y.create.l HWIO_T_DBACK_NONHS_DRM_CFG_WORD24_ADDR A:0x6434e260
y.create.l HWIO_T_DBACK_NONHS_DRM_CFG_WORD25_ADDR A:0x6434e264
y.create.l HWIO_T_DBACK_NONHS_TD_DECIB_WRITER_CFG_WORD0_ADDR A:0x6434e300
y.create.l HWIO_T_DBACK_NONHS_TD_DECIB_WRITER_CFG_WORD1_ADDR A:0x6434e304
y.create.l HWIO_T_DBACK_HS_TD_DECIB_WRITER_CFG_WORD0_ADDR A:0x6434e400
y.create.l HWIO_T_DBACK_HS_TD_DECIB_WRITER_CFG_WORD1_ADDR A:0x6434e404
y.create.l HWIO_T_DBACK_HS_TD_DECIB_WRITER_CFG_WORD2_ADDR A:0x6434e408
y.create.l HWIO_T_DBACK_HS_TD_DECIB_WRITER_CFG_WORD3_ADDR A:0x6434e40c
y.create.l HWIO_T_DBACK_HS_TD_DECIB_WRITER_CFG_WORD4_ADDR A:0x6434e410
y.create.l HWIO_T_DBACK_HS_TD_DECIB_WRITER_CFG_WORD5_ADDR A:0x6434e414
y.create.l HWIO_T_DBACK_HS_TD_DECIB_WRITER_CFG_WORD6_ADDR A:0x6434e418
y.create.l HWIO_T_DBACK_HS_TD_DECIB_WRITER_CFG_WORD7_ADDR A:0x6434e41c
y.create.l HWIO_HDR_DEINT_CFG_WORD0_ADDR A:0x6434f100
y.create.l HWIO_HDR_DEINT_CFG_WORD1_ADDR A:0x6434f104
y.create.l HWIO_HDR_DEINT_CFG_WORD2_ADDR A:0x6434f108
y.create.l HWIO_HDR_DEINT_CFG_WORD3_ADDR A:0x6434f10c
y.create.l HWIO_HDR_DEINT_CFG_WORD4_ADDR A:0x6434f110
y.create.l HWIO_HDR_DEINT_CFG_WORD5_ADDR A:0x6434f114
y.create.l HWIO_HDR_DEINT_CFG_WORD6_ADDR A:0x6434f118
y.create.l HWIO_HDR_DEINT_CFG_WORD7_ADDR A:0x6434f11c
y.create.l HWIO_HDR_DEINT_CFG_WORD8_ADDR A:0x6434f120
y.create.l HWIO_HDR_DEINT_CFG_WORD9_ADDR A:0x6434f124
y.create.l HWIO_HDR_DEINT_CFG_WORD10_ADDR A:0x6434f128
y.create.l HWIO_HDR_DEINT_CFG_WORD11_ADDR A:0x6434f12c
y.create.l HWIO_HDR_DEINT_CFG_WORD12_ADDR A:0x6434f130
y.create.l HWIO_HDR_DEINT_CFG_WORD13_ADDR A:0x6434f134
y.create.l HWIO_HDR_DEINT_CFG_WORD14_ADDR A:0x6434f138
y.create.l HWIO_HDR_DEINT_CFG_WORD15_ADDR A:0x6434f13c
y.create.l HWIO_HDR_DEINT_CFG_WORD16_ADDR A:0x6434f140
y.create.l HWIO_HDR_DEINT_WORD0_ADDR A:0x6434f200
y.create.l HWIO_HDR_DEINT_WORD1_ADDR A:0x6434f204
y.create.l HWIO_HDR_DEINT_WORD2_ADDR A:0x6434f208
y.create.l HWIO_HDR_DEINT_WORD3_ADDR A:0x6434f20c
y.create.l HWIO_HDR_DEINT_WORD4_ADDR A:0x6434f210
y.create.l HWIO_HDR_DEINT_WORD5_ADDR A:0x6434f214
y.create.l HWIO_HDR_DEINT_WORD6_ADDR A:0x6434f218
y.create.l HWIO_HDR_DEINT_WORD7_ADDR A:0x6434f21c
y.create.l HWIO_HDR_DEINT_WORD8_ADDR A:0x6434f220
y.create.l HWIO_HDR_DEINT_WORD9_ADDR A:0x6434f224
y.create.l HWIO_HDR_DEINT_WORD10_ADDR A:0x6434f228
y.create.l HWIO_HDR_DEINT_WORD11_ADDR A:0x6434f22c
y.create.l HWIO_HDR_DEINT_WORD12_ADDR A:0x6434f230
y.create.l HWIO_HDR_DEINT_WORD13_ADDR A:0x6434f234
y.create.l HWIO_TBVD_CCH_STATUS_WORD0_ADDR A:0x64350000
y.create.l HWIO_TBVD_CCH_LTE_CFG_WORD0_ADDR A:0x64350100
y.create.l HWIO_TBVD_CCH_LTE_CFG_WORD1_ADDR A:0x64350104
y.create.l HWIO_TBVD_CCH_LTE_CFG_WORD2_ADDR A:0x64350108
y.create.l HWIO_TBVD_CCH_LTE_CFG_WORD3_ADDR A:0x6435010c
y.create.l HWIO_TBVD_CCH_LTE_CFG_WORD4_ADDR A:0x64350110
y.create.l HWIO_TBVD_CCH_LTE_CFG_WORD5_ADDR A:0x64350114
y.create.l HWIO_TBVD_CCH_LTE_CFG_WORD6_ADDR A:0x64350118
y.create.l HWIO_TBVD_CCH_LTE_CFG_WORD7_ADDR A:0x6435011c
y.create.l HWIO_TBVD_CCH_LTE_CFG_WORD8_ADDR A:0x64350120
y.create.l HWIO_TBVD_CCH_LTE_CFG_WORD9_ADDR A:0x64350124
y.create.l HWIO_TBVD_CCH_LTE_CFG_WORD10_ADDR A:0x64350128
y.create.l HWIO_TBVD_CCH_LTE_CFG_WORD11_ADDR A:0x6435012c
y.create.l HWIO_TBVD_CCH_LTE_CFG_WORD12_ADDR A:0x64350130
y.create.l HWIO_TBVD_CCH_LTE_CFG_WORD13_ADDR A:0x64350134
y.create.l HWIO_TBVD_CCH_LTE_CFG_WORD14_ADDR A:0x64350138
y.create.l HWIO_TBVD_CCH_LTE_CFG_WORD15_ADDR A:0x6435013c
y.create.l HWIO_TBVD_CCH_LTE_CFG_WORD16_ADDR A:0x64350140
y.create.l HWIO_TBVD_CCH_LTE_CFG_WORD17_ADDR A:0x64350144
y.create.l HWIO_TBVD_CCH_LTE_CFG_WORD18_ADDR A:0x64350148
y.create.l HWIO_TBVD_CCH_LTE_CFG_WORD19_ADDR A:0x6435014c
y.create.l HWIO_TBVD_CCH_LTE_PDCCH_WORD0_ADDR A:0x64350200
y.create.l HWIO_TBVD_CCH_LTE_PDCCH_WORD1_ADDR A:0x64350204
y.create.l HWIO_TBVD_CCH_LTE_PDCCH_WORD2_ADDR A:0x64350208
y.create.l HWIO_TBVD_CCH_LTE_PDCCH_WORD3_ADDR A:0x6435020c
y.create.l HWIO_TBVD_CCH_LTE_PDCCH_WORD4_ADDR A:0x64350210
y.create.l HWIO_TBVD_CCH_LTE_PDCCH_WORD5_ADDR A:0x64350214
y.create.l HWIO_TBVD_CCH_LTE_PDCCH_WORD6_ADDR A:0x64350218
y.create.l HWIO_DEC_O_CCH_W_NONHS_LTE_PBCH_WORD0_ADDR A:0x64350300
y.create.l HWIO_DEC_O_CCH_W_NONHS_LTE_PBCH_WORD1_ADDR A:0x64350304
y.create.l HWIO_DEC_O_CCH_W_NONHS_LTE_PBCH_WORD2_ADDR A:0x64350308
y.create.l HWIO_DECOB_MEM_BASE_MIN_ADDR A:0x64350500
y.create.l HWIO_DECOB_MEM_BASE_MIN_INT_ADDR A:0x64358500
y.create.l HWIO_DECOB_MEM_BASE_MAX_ADDR A:0x6435bdfc
y.create.l HWIO_HARQ_PAGE_START_ADDR A:0x6435c000
y.create.l HWIO_HARQ_PAGE_END_ADDR A:0x6435fffc
y.create.l HWIO_TDEC_CLK_CTL_ADDR A:0x6433c000
y.create.l HWIO_TDEC_SW_CLK_EN_ADDR A:0x6433c004
y.create.l HWIO_TDEC_CLK_STATUS_REG_ADDR A:0x6433c008
y.create.l HWIO_TDEC_MODE_CTL_ADDR A:0x6433c00c
y.create.l HWIO_TD_COMMON_CFG0_ADDR A:0x6433c020
y.create.l HWIO_TD_COMMON_CFG1_ADDR A:0x6433c024
y.create.l HWIO_TD_COMMON_CFG2_ADDR A:0x6433c028
y.create.l HWIO_TD_COMMON_CFG3_ADDR A:0x6433c02c
y.create.l HWIO_TD_COMMON_CFG4_ADDR A:0x6433c030
y.create.l HWIO_TD_COMMON_CFG5_ADDR A:0x6433c034
y.create.l HWIO_TD_COMMON_START_ADDR A:0x6433c038
y.create.l HWIO_TD_1X_CFG_ADDR A:0x6433c03c
y.create.l HWIO_TD_1X_DECOB_WRITE_PTR_ADDR A:0x6433c040
y.create.l HWIO_TDEC_HW_IDLE_ADDR A:0x6433c044
y.create.l HWIO_TDEC_PING_STATUS_0_ADDR A:0x6433c048
y.create.l HWIO_TDEC_PING_STATUS_1_ADDR A:0x6433c04c
y.create.l HWIO_TDEC_PONG_STATUS_0_ADDR A:0x6433c050
y.create.l HWIO_TDEC_PONG_STATUS_1_ADDR A:0x6433c054
y.create.l HWIO_TDEC_GERAN_STATUS_0_ADDR A:0x6433c058
y.create.l HWIO_TDEC_GERAN_STATUS_1_ADDR A:0x6433c05c
y.create.l HWIO_TDEC_TESTBUS_ENABLE_ADDR A:0x6433c060
y.create.l HWIO_TDEC_TESTBUS_STATUS_ADDR A:0x6433c064
y.create.l HWIO_DECIB_PAGE_ID_ADDR A:0x6433c068
y.create.l HWIO_TDEC_AHB_ERROR_ADDR_RD_ADDR A:0x6433c070
y.create.l HWIO_TEST_CRC_000_RD_ADDR A:0x6433c074
y.create.l HWIO_TEST_CRC_001_RD_ADDR A:0x6433c078
y.create.l HWIO_TEST_CRC_010_RD_ADDR A:0x6433c07c
y.create.l HWIO_TEST_CRC_011_RD_ADDR A:0x6433c080
y.create.l HWIO_TEST_CRC_100_RD_ADDR A:0x6433c084
y.create.l HWIO_TEST_CRC_101_RD_ADDR A:0x6433c088
y.create.l HWIO_TEST_CRC_110_RD_ADDR A:0x6433c08c
y.create.l HWIO_TEST_CRC_111_RD_ADDR A:0x6433c090
y.create.l HWIO_A2_TEST_SW_CFG_DATA0_ADDR A:0x6433c094
y.create.l HWIO_A2_TEST_SW_CFG_DATA1_ADDR A:0x6433c098
y.create.l HWIO_A2_TEST_SW_CFG_DATA2_ADDR A:0x6433c09c
y.create.l HWIO_A2_TEST_SW_CFG_DATA3_ADDR A:0x6433c0a0
y.create.l HWIO_A2_TEST_SW_CFG_DATA4_ADDR A:0x6433c0a4
y.create.l HWIO_TD_CFG_STATUS_WORD0_ADDR A:0x6433d000
y.create.l HWIO_LTE_CFG_WORD0_ADDR A:0x6433d100
y.create.l HWIO_LTE_CFG_WORD1_ADDR A:0x6433d104
y.create.l HWIO_LTE_CFG_WORD2_ADDR A:0x6433d108
y.create.l HWIO_W_TD_CFG_WORD0_0_ADDR A:0x6433d200
y.create.l HWIO_W_TD_CFG_WORD1_0_ADDR A:0x6433d204
y.create.l HWIO_W_TD_CFG_WORD2_0_ADDR A:0x6433d208
y.create.l HWIO_W_TD_CFG_WORD3_0_ADDR A:0x6433d20c
y.create.l HWIO_W_TD_CFG_WORD4_0_ADDR A:0x6433d210
y.create.l HWIO_W_TD_CFG_WORD5_0_ADDR A:0x6433d214
y.create.l HWIO_W_TD_CFG_WORD6_0_ADDR A:0x6433d218
y.create.l HWIO_W_TD_CFG_WORD7_0_ADDR A:0x6433d21c
y.create.l HWIO_W_TD_CFG_WORD8_0_ADDR A:0x6433d220
y.create.l HWIO_W_TD_CFG_WORD9_0_ADDR A:0x6433d224
y.create.l HWIO_W_TD_CFG_WORD0_1_ADDR A:0x6433d300
y.create.l HWIO_W_TD_CFG_WORD1_1_ADDR A:0x6433d304
y.create.l HWIO_W_TD_CFG_WORD2_1_ADDR A:0x6433d308
y.create.l HWIO_W_TD_CFG_WORD3_1_ADDR A:0x6433d30c
y.create.l HWIO_W_TD_CFG_WORD4_1_ADDR A:0x6433d310
y.create.l HWIO_W_TD_CFG_WORD5_1_ADDR A:0x6433d314
y.create.l HWIO_W_TD_CFG_WORD6_1_ADDR A:0x6433d318
y.create.l HWIO_W_TD_CFG_WORD7_1_ADDR A:0x6433d31c
y.create.l HWIO_W_TD_CFG_WORD8_1_ADDR A:0x6433d320
y.create.l HWIO_W_TD_CFG_WORD9_1_ADDR A:0x6433d324
y.create.l HWIO_LTE_TRBLK_CFG_WORD0_0_ADDR A:0x6433d400
y.create.l HWIO_LTE_TRBLK_CFG_WORD1_0_ADDR A:0x6433d404
y.create.l HWIO_LTE_TRBLK_CFG_WORD2_0_ADDR A:0x6433d408
y.create.l HWIO_LTE_TRBLK_CFG_WORD3_0_ADDR A:0x6433d40c
y.create.l HWIO_LTE_TRBLK_CFG_WORD4_0_ADDR A:0x6433d410
y.create.l HWIO_LTE_TRBLK_CFG_WORD5_0_ADDR A:0x6433d414
y.create.l HWIO_LTE_TRBLK_CFG_WORD0_1_ADDR A:0x6433d500
y.create.l HWIO_LTE_TRBLK_CFG_WORD1_1_ADDR A:0x6433d504
y.create.l HWIO_LTE_TRBLK_CFG_WORD2_1_ADDR A:0x6433d508
y.create.l HWIO_LTE_TRBLK_CFG_WORD3_1_ADDR A:0x6433d50c
y.create.l HWIO_LTE_TRBLK_CFG_WORD4_1_ADDR A:0x6433d510
y.create.l HWIO_LTE_TRBLK_CFG_WORD5_1_ADDR A:0x6433d514
y.create.l HWIO_GERAN_TD_CFG_WORD0_0_ADDR A:0x6433d600
y.create.l HWIO_GERAN_TD_CFG_WORD1_0_ADDR A:0x6433d604
y.create.l HWIO_GERAN_TD_CFG_WORD2_0_ADDR A:0x6433d608
y.create.l HWIO_GERAN_TD_CFG_WORD3_0_ADDR A:0x6433d60c
y.create.l HWIO_GERAN_TD_CFG_WORD0_1_ADDR A:0x6433d700
y.create.l HWIO_GERAN_TD_CFG_WORD1_1_ADDR A:0x6433d704
y.create.l HWIO_GERAN_TD_CFG_WORD2_1_ADDR A:0x6433d708
y.create.l HWIO_GERAN_TD_CFG_WORD3_1_ADDR A:0x6433d70c
y.create.l HWIO_HDR_TD_CFG_WORD0_0_ADDR A:0x6433d800
y.create.l HWIO_HDR_TD_CFG_WORD1_0_ADDR A:0x6433d804
y.create.l HWIO_HDR_TD_CFG_WORD2_0_ADDR A:0x6433d808
y.create.l HWIO_HDR_TD_CFG_WORD0_1_ADDR A:0x6433d900
y.create.l HWIO_HDR_TD_CFG_WORD1_1_ADDR A:0x6433d904
y.create.l HWIO_HDR_TD_CFG_WORD2_1_ADDR A:0x6433d908
y.create.l HWIO_TD_STATUS_WORD0_ADDR A:0x6433e000
y.create.l HWIO_W_TD_WORD0_0_ADDR A:0x6433e100
y.create.l HWIO_W_TD_WORD0_1_ADDR A:0x6433e200
y.create.l HWIO_LTE_PDSCH_WORD0_0_ADDR A:0x6433e300
y.create.l HWIO_LTE_PDSCH_WORD1_0_ADDR A:0x6433e304
y.create.l HWIO_LTE_PDSCH_WORD2_0_ADDR A:0x6433e308
y.create.l HWIO_LTE_PDSCH_WORD0_1_ADDR A:0x6433e400
y.create.l HWIO_LTE_PDSCH_WORD1_1_ADDR A:0x6433e404
y.create.l HWIO_LTE_PDSCH_WORD2_1_ADDR A:0x6433e408
y.create.l HWIO_GERAN_TD_WORD0_0_ADDR A:0x6433e500
y.create.l HWIO_GERAN_TD_WORD1_0_ADDR A:0x6433e504
y.create.l HWIO_GERAN_TD_WORD2_0_ADDR A:0x6433e508
y.create.l HWIO_GERAN_TD_WORD3_0_ADDR A:0x6433e50c
y.create.l HWIO_GERAN_TD_WORD4_0_ADDR A:0x6433e510
y.create.l HWIO_GERAN_TD_WORD5_0_ADDR A:0x6433e514
y.create.l HWIO_GERAN_TD_WORD6_0_ADDR A:0x6433e518
y.create.l HWIO_GERAN_TD_WORD0_1_ADDR A:0x6433e600
y.create.l HWIO_GERAN_TD_WORD1_1_ADDR A:0x6433e604
y.create.l HWIO_GERAN_TD_WORD2_1_ADDR A:0x6433e608
y.create.l HWIO_GERAN_TD_WORD3_1_ADDR A:0x6433e60c
y.create.l HWIO_GERAN_TD_WORD4_1_ADDR A:0x6433e610
y.create.l HWIO_GERAN_TD_WORD5_1_ADDR A:0x6433e614
y.create.l HWIO_GERAN_TD_WORD6_1_ADDR A:0x6433e618
y.create.l HWIO_HDR_TD_WORD0_0_ADDR A:0x6433e700
y.create.l HWIO_HDR_TD_WORD1_0_ADDR A:0x6433e704
y.create.l HWIO_HDR_TD_WORD2_0_ADDR A:0x6433e708
y.create.l HWIO_HDR_TD_WORD3_0_ADDR A:0x6433e70c
y.create.l HWIO_HDR_TD_WORD4_0_ADDR A:0x6433e710
y.create.l HWIO_HDR_TD_WORD5_0_ADDR A:0x6433e714
y.create.l HWIO_HDR_TD_WORD0_1_ADDR A:0x6433e800
y.create.l HWIO_HDR_TD_WORD1_1_ADDR A:0x6433e804
y.create.l HWIO_HDR_TD_WORD2_1_ADDR A:0x6433e808
y.create.l HWIO_HDR_TD_WORD3_1_ADDR A:0x6433e80c
y.create.l HWIO_HDR_TD_WORD4_1_ADDR A:0x6433e810
y.create.l HWIO_HDR_TD_WORD5_1_ADDR A:0x6433e814
y.create.l HWIO_TDECIB_MEM_START_ADDR A:0x6433f000
y.create.l HWIO_TDECIB_MEM_END_ADDR A:0x6433fffc
y.create.l HWIO_PDMEM_MIN_ADDR A:0x64300000
y.create.l HWIO_PDMEM_MAX_ADDR A:0x6430fffc
y.create.l HWIO_CCS_MSTS_ADDR A:0x6431fc00
y.create.l HWIO_CCS_MCTL_ADDR A:0x6431fc04
y.create.l HWIO_CCS_IPC_ADDR A:0x6431fc08
y.create.l HWIO_CCS_PIC0MSK_ADDR A:0x6431fc0c
y.create.l HWIO_CCS_PIC0STS_ADDR A:0x6431fc10
y.create.l HWIO_CCS_PIC1MSK_ADDR A:0x6431fc14
y.create.l HWIO_CCS_PIC1STS_ADDR A:0x6431fc18
y.create.l HWIO_CCS_PIC2MSK_ADDR A:0x6431fc1c
y.create.l HWIO_CCS_PIC2STS_ADDR A:0x6431fc20
y.create.l HWIO_CCS_PIC3MSK_ADDR A:0x6431fc24
y.create.l HWIO_CCS_PIC3STS_ADDR A:0x6431fc28
y.create.l HWIO_CCS_PIC4MSK_ADDR A:0x6431fc2c
y.create.l HWIO_CCS_PIC4STS_ADDR A:0x6431fc30
y.create.l HWIO_CCS_PIC5MSK_ADDR A:0x6431fc34
y.create.l HWIO_CCS_PIC5STS_ADDR A:0x6431fc38
y.create.l HWIO_CCS_PIC6MSK_ADDR A:0x6431fc3c
y.create.l HWIO_CCS_PIC6STS_ADDR A:0x6431fc40
y.create.l HWIO_CCS_PIT_ADDR A:0x6431fc44
y.create.l HWIO_CCS_UTIME_ADDR A:0x6431fc48
y.create.l HWIO_CCS_MON0_ADDR A:0x6431fc4c
y.create.l HWIO_CCS_MON1_ADDR A:0x6431fc50
y.create.l HWIO_CCS_MON2_ADDR A:0x6431fc54
y.create.l HWIO_CCS_MON3_ADDR A:0x6431fc58
y.create.l HWIO_CCS_MON4_ADDR A:0x6431fc5c
y.create.l HWIO_CCS_MON5_ADDR A:0x6431fc60
y.create.l HWIO_CCS_MON6_ADDR A:0x6431fc64
y.create.l HWIO_CCS_MON7_ADDR A:0x6431fc68
y.create.l HWIO_CCS_MON8_ADDR A:0x6431fc6c
y.create.l HWIO_CCS_MON9_ADDR A:0x6431fc70
y.create.l HWIO_CCS_TMR0_ADDR A:0x6431fc7c
y.create.l HWIO_CCS_TMR1_ADDR A:0x6431fc80
y.create.l HWIO_CCS_TMR2_ADDR A:0x6431fc84
y.create.l HWIO_CCS_TMR3_ADDR A:0x6431fc88
y.create.l HWIO_CCS_DMAC_ADDR A:0x6431fc8c
y.create.l HWIO_CCS_DMAC0SRC_ADDR A:0x6431fc90
y.create.l HWIO_CCS_DMAC1SRC_ADDR A:0x6431fca0
y.create.l HWIO_CCS_DMAC2SRC_ADDR A:0x6431fcb0
y.create.l HWIO_CCS_DMAC3SRC_ADDR A:0x6431fcc0
y.create.l HWIO_CCS_DMAC4SRC_ADDR A:0x6431fcd0
y.create.l HWIO_CCS_DMAC5SRC_ADDR A:0x6431fce0
y.create.l HWIO_CCS_DMAC6SRC_ADDR A:0x6431fcf0
y.create.l HWIO_CCS_DMAC7SRC_ADDR A:0x6431fd00
y.create.l HWIO_CCS_DMAC0DST_ADDR A:0x6431fc94
y.create.l HWIO_CCS_DMAC1DST_ADDR A:0x6431fca4
y.create.l HWIO_CCS_DMAC2DST_ADDR A:0x6431fcb4
y.create.l HWIO_CCS_DMAC3DST_ADDR A:0x6431fcc4
y.create.l HWIO_CCS_DMAC4DST_ADDR A:0x6431fcd4
y.create.l HWIO_CCS_DMAC5DST_ADDR A:0x6431fce4
y.create.l HWIO_CCS_DMAC6DST_ADDR A:0x6431fcf4
y.create.l HWIO_CCS_DMAC7DST_ADDR A:0x6431fd04
y.create.l HWIO_CCS_DMAC0LNK_ADDR A:0x6431fc98
y.create.l HWIO_CCS_DMAC1LNK_ADDR A:0x6431fca8
y.create.l HWIO_CCS_DMAC2LNK_ADDR A:0x6431fcb8
y.create.l HWIO_CCS_DMAC3LNK_ADDR A:0x6431fcc8
y.create.l HWIO_CCS_DMAC4LNK_ADDR A:0x6431fcd8
y.create.l HWIO_CCS_DMAC5LNK_ADDR A:0x6431fce8
y.create.l HWIO_CCS_DMAC6LNK_ADDR A:0x6431fcf8
y.create.l HWIO_CCS_DMAC7LNK_ADDR A:0x6431fd08
y.create.l HWIO_CCS_DMAC0CTL_ADDR A:0x6431fc9c
y.create.l HWIO_CCS_DMAC1CTL_ADDR A:0x6431fcac
y.create.l HWIO_CCS_DMAC2CTL_ADDR A:0x6431fcbc
y.create.l HWIO_CCS_DMAC3CTL_ADDR A:0x6431fccc
y.create.l HWIO_CCS_DMAC4CTL_ADDR A:0x6431fcdc
y.create.l HWIO_CCS_DMAC5CTL_ADDR A:0x6431fcec
y.create.l HWIO_CCS_DMAC6CTL_ADDR A:0x6431fcfc
y.create.l HWIO_CCS_DMAC7CTL_ADDR A:0x6431fd0c
y.create.l HWIO_CCS_RFI_ADDR A:0x6431fd10
y.create.l HWIO_CCS_SSBI0_ADDR A:0x6431fd14
y.create.l HWIO_CCS_SSBI1_ADDR A:0x6431fd1c
y.create.l HWIO_CCS_SSBI2_ADDR A:0x6431fd24
y.create.l HWIO_CCS_SSBI3_ADDR A:0x6431fd2c
y.create.l HWIO_CCS_SSBI0DAT_ADDR A:0x6431fd18
y.create.l HWIO_CCS_SSBI1DAT_ADDR A:0x6431fd20
y.create.l HWIO_CCS_SSBI2DAT_ADDR A:0x6431fd28
y.create.l HWIO_CCS_SSBI3DAT_ADDR A:0x6431fd30
y.create.l HWIO_CCS_GRFC_SET_ADDR A:0x6431fd44
y.create.l HWIO_CCS_GRFC_CLR_ADDR A:0x6431fd48
y.create.l HWIO_CCS_RFFE0_ADDR A:0x6431fd4c
y.create.l HWIO_CCS_RFFE1_ADDR A:0x6431fd64
y.create.l HWIO_CCS_RFFE2_ADDR A:0x6431fd7c
y.create.l HWIO_CCS_RFFE3_ADDR A:0x6431fd94
y.create.l HWIO_CCS_RFFE4_ADDR A:0x6431fdac
y.create.l HWIO_CCS_RFFE0DAT0_ADDR A:0x6431fd50
y.create.l HWIO_CCS_RFFE1DAT0_ADDR A:0x6431fd68
y.create.l HWIO_CCS_RFFE2DAT0_ADDR A:0x6431fd80
y.create.l HWIO_CCS_RFFE3DAT0_ADDR A:0x6431fd98
y.create.l HWIO_CCS_RFFE4DAT0_ADDR A:0x6431fdb0
y.create.l HWIO_CCS_RFFE0DAT1_ADDR A:0x6431fd54
y.create.l HWIO_CCS_RFFE1DAT1_ADDR A:0x6431fd6c
y.create.l HWIO_CCS_RFFE2DAT1_ADDR A:0x6431fd84
y.create.l HWIO_CCS_RFFE3DAT1_ADDR A:0x6431fd9c
y.create.l HWIO_CCS_RFFE4DAT1_ADDR A:0x6431fdb4
y.create.l HWIO_CCS_RFFE0DAT2_ADDR A:0x6431fd58
y.create.l HWIO_CCS_RFFE1DAT2_ADDR A:0x6431fd70
y.create.l HWIO_CCS_RFFE2DAT2_ADDR A:0x6431fd88
y.create.l HWIO_CCS_RFFE3DAT2_ADDR A:0x6431fda0
y.create.l HWIO_CCS_RFFE4DAT2_ADDR A:0x6431fdb8
y.create.l HWIO_CCS_RFFE0DAT3_ADDR A:0x6431fd5c
y.create.l HWIO_CCS_RFFE1DAT3_ADDR A:0x6431fd74
y.create.l HWIO_CCS_RFFE2DAT3_ADDR A:0x6431fd8c
y.create.l HWIO_CCS_RFFE3DAT3_ADDR A:0x6431fda4
y.create.l HWIO_CCS_RFFE4DAT3_ADDR A:0x6431fdbc
y.create.l HWIO_CCS_RFFE0_STS_ADDR A:0x6431fd60
y.create.l HWIO_CCS_RFFE1_STS_ADDR A:0x6431fd78
y.create.l HWIO_CCS_RFFE2_STS_ADDR A:0x6431fd90
y.create.l HWIO_CCS_RFFE3_STS_ADDR A:0x6431fda8
y.create.l HWIO_CCS_RFFE4_STS_ADDR A:0x6431fdc0
y.create.l HWIO_CCS_BP0_ADDR A:0x6431fe3c
y.create.l HWIO_CCS_BP1_ADDR A:0x6431fe40
y.create.l HWIO_MTC_ENABLE_ADDR A:0x64320000
y.create.l HWIO_MODEM_PWRUP_ADDR A:0x64320004
y.create.l HWIO_MODEM_PWRON_ADDR A:0x64320008
y.create.l HWIO_MODEM_ID_ADDR A:0x6432000c
y.create.l HWIO_MODEM_FEATURE_EN_ADDR A:0x64320010
y.create.l HWIO_MODEM_OPTION_EN_ADDR A:0x64320014
y.create.l HWIO_MODEM_CLK_AXI_CFG_ADDR A:0x64320018
y.create.l HWIO_MODEM_CLK_AXI_TRIG_ADDR A:0x6432001c
y.create.l HWIO_MODEM_CLK_AXI_STATUS_ADDR A:0x64320020
y.create.l HWIO_MODEM_CLK_TDEC_CFG_ADDR A:0x64320024
y.create.l HWIO_MODEM_CLK_TDEC_TRIG_ADDR A:0x64320028
y.create.l HWIO_MODEM_CLK_TDEC_STATUS_ADDR A:0x6432002c
y.create.l HWIO_MODEM_CLK_DBG_CFG_ADDR A:0x64320030
y.create.l HWIO_MODEM_CLK_SPARE_ADDR A:0x64320034
y.create.l HWIO_MCDMA_RESET_ADDR A:0x64320400
y.create.l HWIO_MCDMA_ENABLE_ADDR A:0x6432049c
y.create.l HWIO_MCDMA_LOG_CH_BUSY_ADDR A:0x64320404
y.create.l HWIO_MCDMA_LOG_HW_CH0_SYNC_ADDR A:0x64320408
y.create.l HWIO_MCDMA_LOG_HW_CH1_SYNC_ADDR A:0x6432040c
y.create.l HWIO_MCDMA_LOG_HW_CH2_SYNC_ADDR A:0x64320410
y.create.l HWIO_MCDMA_LOG_HW_CH3_SYNC_ADDR A:0x64320414
y.create.l HWIO_MCDMA_LOG_HW_CH4_SYNC_ADDR A:0x64320418
y.create.l HWIO_MCDMA_LOG_HW_CH0_CTL_ADDR A:0x64320420
y.create.l HWIO_MCDMA_LOG_HW_CH1_CTL_ADDR A:0x64320424
y.create.l HWIO_MCDMA_LOG_HW_CH2_CTL_ADDR A:0x64320428
y.create.l HWIO_MCDMA_LOG_HW_CH3_CTL_ADDR A:0x6432042c
y.create.l HWIO_MCDMA_LOG_HW_CH4_CTL_ADDR A:0x64320430
y.create.l HWIO_MCDMA_LOG_SW_CH0_RESET_ADDR A:0x64320438
y.create.l HWIO_MCDMA_LOG_SW_CH1_RESET_ADDR A:0x6432043c
y.create.l HWIO_MCDMA_LOG_SW_CH2_RESET_ADDR A:0x64320440
y.create.l HWIO_MCDMA_LOG_SW_CH3_RESET_ADDR A:0x64320444
y.create.l HWIO_MCDMA_LOG_SW_CH0_CTL_ADDR A:0x6432044c
y.create.l HWIO_MCDMA_LOG_SW_CH1_CTL_ADDR A:0x64320450
y.create.l HWIO_MCDMA_LOG_SW_CH2_CTL_ADDR A:0x64320454
y.create.l HWIO_MCDMA_LOG_SW_CH3_CTL_ADDR A:0x64320458
y.create.l HWIO_MCDMA_PHY_CH_CTL_ADDR A:0x64320460
y.create.l HWIO_MCDMA_LOG_HW_CH0_DBG_ADDR A:0x64320464
y.create.l HWIO_MCDMA_LOG_HW_CH1_DBG_ADDR A:0x64320468
y.create.l HWIO_MCDMA_LOG_HW_CH2_DBG_ADDR A:0x6432046c
y.create.l HWIO_MCDMA_LOG_HW_CH3_DBG_ADDR A:0x64320470
y.create.l HWIO_MCDMA_LOG_HW_CH4_DBG_ADDR A:0x64320474
y.create.l HWIO_MCDMA_LOG_SW_CH0_DBG_ADDR A:0x64320478
y.create.l HWIO_MCDMA_LOG_SW_CH1_DBG_ADDR A:0x6432047c
y.create.l HWIO_MCDMA_LOG_SW_CH2_DBG_ADDR A:0x64320480
y.create.l HWIO_MCDMA_LOG_SW_CH3_DBG_ADDR A:0x64320484
y.create.l HWIO_MCDMA_PHY_CH_DBG_ADDR A:0x64320488
y.create.l HWIO_MCDMA_VBUF_CFG_DBG_ADDR A:0x6432048c
y.create.l HWIO_MCDMA_VBUF_CFG_SEL_ADDR A:0x64320490
y.create.l HWIO_MCDMA_VBUF_CFG_RD0_ADDR A:0x64320494
y.create.l HWIO_MCDMA_VBUF_CFG_RD1_ADDR A:0x64320498
y.create.l HWIO_A2_SW_RESET_THRD_ADDR A:0x64320800
y.create.l HWIO_A2_SW_RESET_ACC_ADDR A:0x64320804
y.create.l HWIO_A2_TASK0_EN_ADDR A:0x64320808
y.create.l HWIO_A2_TASK1_EN_ADDR A:0x6432080c
y.create.l HWIO_A2_TASK2_EN_ADDR A:0x64320810
y.create.l HWIO_A2_TASK3_EN_ADDR A:0x64320814
y.create.l HWIO_A2_TASK0_WR_PTR_ADDR A:0x64320820
y.create.l HWIO_A2_TASK1_WR_PTR_ADDR A:0x64320824
y.create.l HWIO_A2_TASK2_WR_PTR_ADDR A:0x64320828
y.create.l HWIO_A2_TASK3_WR_PTR_ADDR A:0x6432082c
y.create.l HWIO_A2_TASK0_RD_PTR_ADDR A:0x64320840
y.create.l HWIO_A2_TASK1_RD_PTR_ADDR A:0x64320844
y.create.l HWIO_A2_TASK2_RD_PTR_ADDR A:0x64320848
y.create.l HWIO_A2_TASK3_RD_PTR_ADDR A:0x6432084c
y.create.l HWIO_A2_TASK0_RD_PTR_INIT_ADDR A:0x64320860
y.create.l HWIO_A2_TASK1_RD_PTR_INIT_ADDR A:0x64320864
y.create.l HWIO_A2_TASK2_RD_PTR_INIT_ADDR A:0x64320868
y.create.l HWIO_A2_TASK3_RD_PTR_INIT_ADDR A:0x6432086c
y.create.l HWIO_A2_TASK0_RD_PTR_INIT_EN_ADDR A:0x64320880
y.create.l HWIO_A2_TASK1_RD_PTR_INIT_EN_ADDR A:0x64320884
y.create.l HWIO_A2_TASK2_RD_PTR_INIT_EN_ADDR A:0x64320888
y.create.l HWIO_A2_TASK3_RD_PTR_INIT_EN_ADDR A:0x6432088c
y.create.l HWIO_A2_QUEUE_UPPER_ADDR_ADDR A:0x643208b0
y.create.l HWIO_A2_STATUS0_WR_EN_ADDR A:0x643208c8
y.create.l HWIO_A2_STATUS1_WR_EN_ADDR A:0x643208cc
y.create.l HWIO_A2_STATUS2_WR_EN_ADDR A:0x643208d0
y.create.l HWIO_A2_STATUS3_WR_EN_ADDR A:0x643208d4
y.create.l HWIO_A2_STATUS4_WR_EN_ADDR A:0x643208d8
y.create.l HWIO_A2_STATUS0_WR_START_ADDR A:0x643208dc
y.create.l HWIO_A2_STATUS1_WR_START_ADDR A:0x643208e0
y.create.l HWIO_A2_STATUS2_WR_START_ADDR A:0x643208e4
y.create.l HWIO_A2_STATUS3_WR_START_ADDR A:0x643208e8
y.create.l HWIO_A2_STATUS4_WR_START_ADDR A:0x643208ec
y.create.l HWIO_A2_STATUS0_WR_END_ADDR A:0x643208f0
y.create.l HWIO_A2_STATUS1_WR_END_ADDR A:0x643208f4
y.create.l HWIO_A2_STATUS2_WR_END_ADDR A:0x643208f8
y.create.l HWIO_A2_STATUS3_WR_END_ADDR A:0x643208fc
y.create.l HWIO_A2_STATUS4_WR_END_ADDR A:0x64320900
y.create.l HWIO_A2_STATUS0_WR_PTR_INIT_ADDR A:0x64320904
y.create.l HWIO_A2_STATUS1_WR_PTR_INIT_ADDR A:0x64320908
y.create.l HWIO_A2_STATUS2_WR_PTR_INIT_ADDR A:0x6432090c
y.create.l HWIO_A2_STATUS3_WR_PTR_INIT_ADDR A:0x64320910
y.create.l HWIO_A2_STATUS4_WR_PTR_INIT_ADDR A:0x64320914
y.create.l HWIO_A2_STATUS0_WR_PTR_INIT_EN_ADDR A:0x64320918
y.create.l HWIO_A2_STATUS1_WR_PTR_INIT_EN_ADDR A:0x6432091c
y.create.l HWIO_A2_STATUS2_WR_PTR_INIT_EN_ADDR A:0x64320920
y.create.l HWIO_A2_STATUS3_WR_PTR_INIT_EN_ADDR A:0x64320924
y.create.l HWIO_A2_STATUS4_WR_PTR_INIT_EN_ADDR A:0x64320928
y.create.l HWIO_A2_STATUS0_WR_PTR_CURRENT_ADDR A:0x6432092c
y.create.l HWIO_A2_STATUS1_WR_PTR_CURRENT_ADDR A:0x64320930
y.create.l HWIO_A2_STATUS2_WR_PTR_CURRENT_ADDR A:0x64320934
y.create.l HWIO_A2_STATUS3_WR_PTR_CURRENT_ADDR A:0x64320938
y.create.l HWIO_A2_STATUS4_WR_PTR_CURRENT_ADDR A:0x6432093c
y.create.l HWIO_A2_STATUS0_WR_PTR_ADDR A:0x64320940
y.create.l HWIO_A2_STATUS1_WR_PTR_ADDR A:0x64320944
y.create.l HWIO_A2_STATUS2_WR_PTR_ADDR A:0x64320948
y.create.l HWIO_A2_STATUS3_WR_PTR_ADDR A:0x6432094c
y.create.l HWIO_A2_STATUS4_WR_PTR_ADDR A:0x64320950
y.create.l HWIO_A2_STATUS0_RD_PTR_ADDR A:0x64320954
y.create.l HWIO_A2_STATUS1_RD_PTR_ADDR A:0x64320958
y.create.l HWIO_A2_STATUS2_RD_PTR_ADDR A:0x6432095c
y.create.l HWIO_A2_STATUS3_RD_PTR_ADDR A:0x64320960
y.create.l HWIO_A2_STATUS4_RD_PTR_ADDR A:0x64320964
y.create.l HWIO_A2_FRAG0_THRESHOLD_ADDR A:0x643209c0
y.create.l HWIO_A2_FRAG1_THRESHOLD_ADDR A:0x643209c4
y.create.l HWIO_A2_FRAG0_REFILL_EN_ADDR A:0x643209c8
y.create.l HWIO_A2_FRAG1_REFILL_EN_ADDR A:0x643209cc
y.create.l HWIO_A2_FRAG0_LEN_ADDR A:0x643209d0
y.create.l HWIO_A2_FRAG1_LEN_ADDR A:0x643209d4
y.create.l HWIO_A2_FRAG0_ADDR_ADDR A:0x643209d8
y.create.l HWIO_A2_FRAG1_ADDR_ADDR A:0x643209dc
y.create.l HWIO_A2_FRAG0_PTR_ADDR A:0x643209e0
y.create.l HWIO_A2_FRAG1_PTR_ADDR A:0x643209e4
y.create.l HWIO_A2_FRAG_CACHE_LINE_ADDR A:0x643209e8
y.create.l HWIO_A2_FRAG_CACHE_LINE_MASK_ADDR A:0x643209ec
y.create.l HWIO_A2_FRAG0_TRANSFER_LEN_ADDR A:0x643209f0
y.create.l HWIO_A2_FRAG1_TRANSFER_LEN_ADDR A:0x643209f4
y.create.l HWIO_A2_FRAG0_HDR_LEN_ADDR A:0x643209f8
y.create.l HWIO_A2_FRAG1_HDR_LEN_ADDR A:0x643209fc
y.create.l HWIO_A2_FRAG0_QUEUE_START_ADDR_ADDR A:0x64320a08
y.create.l HWIO_A2_FRAG1_QUEUE_START_ADDR_ADDR A:0x64320a0c
y.create.l HWIO_A2_FRAG0_QUEUE_WR_PTR_ADDR A:0x64320aa0
y.create.l HWIO_A2_FRAG1_QUEUE_WR_PTR_ADDR A:0x64320aa4
y.create.l HWIO_A2_FRAG0_QUEUE_RD_PTR_ADDR A:0x64320aa8
y.create.l HWIO_A2_FRAG1_QUEUE_RD_PTR_ADDR A:0x64320aac
y.create.l HWIO_A2_FRAG0_RD_PTR_INIT_EN_ADDR A:0x64320acc
y.create.l HWIO_A2_FRAG1_RD_PTR_INIT_EN_ADDR A:0x64320ad0
y.create.l HWIO_A2_TIMER0_CFG_ADDR A:0x64320a10
y.create.l HWIO_A2_TIMER1_CFG_ADDR A:0x64320a14
y.create.l HWIO_A2_TIMER2_CFG_ADDR A:0x64320a18
y.create.l HWIO_A2_TIMER3_CFG_ADDR A:0x64320a1c
y.create.l HWIO_A2_TIMER0_CMD_ADDR A:0x64320a20
y.create.l HWIO_A2_TIMER1_CMD_ADDR A:0x64320a24
y.create.l HWIO_A2_TIMER2_CMD_ADDR A:0x64320a28
y.create.l HWIO_A2_TIMER3_CMD_ADDR A:0x64320a2c
y.create.l HWIO_A2_TIMER0_PERIOD_ADDR A:0x64320a40
y.create.l HWIO_A2_TIMER1_PERIOD_ADDR A:0x64320a44
y.create.l HWIO_A2_TIMER2_PERIOD_ADDR A:0x64320a48
y.create.l HWIO_A2_TIMER3_PERIOD_ADDR A:0x64320a4c
y.create.l HWIO_A2_TIMER0_STATUS_ADDR A:0x64320a50
y.create.l HWIO_A2_TIMER1_STATUS_ADDR A:0x64320a54
y.create.l HWIO_A2_TIMER2_STATUS_ADDR A:0x64320a58
y.create.l HWIO_A2_TIMER3_STATUS_ADDR A:0x64320a5c
y.create.l HWIO_A2_PER_DL_CFG_ADDR A:0x64320a70
y.create.l HWIO_A2_PER0_UL_CFG_ADDR A:0x64320a74
y.create.l HWIO_A2_PER1_UL_CFG_ADDR A:0x64320a78
y.create.l HWIO_A2_PER2_UL_CFG_ADDR A:0x64320a7c
y.create.l HWIO_A2_CKSUM_CFG_ADDR A:0x64320adc
y.create.l HWIO_A2_DL_PHY_DEC_TRBLK_THRESHOLD_ADDR A:0x64320a90
y.create.l HWIO_A2_DL_PHY_CFG_ADDR A:0x64320a94
y.create.l HWIO_A2_HW_THRD_EN_ADDR A:0x64320a98
y.create.l HWIO_A2_UL_PHY_CFG_ADDR A:0x64320a9c
y.create.l HWIO_A2_LTE_DLPHY_CMD_ADDR_ADDR A:0x64320ab0
y.create.l HWIO_A2_IP_FILT_FRAG_ADDR_ADDR A:0x64320ab4
y.create.l HWIO_A2_MCDMA_DMA_IN_ADDR_ADDR A:0x64320ab8
y.create.l HWIO_A2_MCDMA_DMA_OUT_ADDR_ADDR A:0x64320abc
y.create.l HWIO_A2_MCDMA_TASK_ADDR_ADDR A:0x64320ac0
y.create.l HWIO_A2_MCDMA_BAM_NDP_ADDR_ADDR A:0x64320ac4
y.create.l HWIO_A2_DECOB_PREFETCH_ADDR_ADDR A:0x64320ac8
y.create.l HWIO_A2_MCDMA_OST_BRST_ADDR A:0x64320ad4
y.create.l HWIO_A2_MCDMA_MAX_BRST_SIZE_ADDR A:0x64320ad8
y.create.l HWIO_A2_HW_CLK_CTL_ADDR A:0x64320ae0
y.create.l HWIO_A2_CLK_EN_CTL_ADDR A:0x64320ae4
y.create.l HWIO_A2_CLK_STATUS_ADDR A:0x64320ae8
y.create.l HWIO_A2_UL_PER_1ST_PKT_INT_EN_ADDR A:0x64320aec
y.create.l HWIO_A2_DBG_LINK_RD_ADDR A:0x64320af0
y.create.l HWIO_A2_DBG_LINK1_RD_ADDR A:0x64320af4
y.create.l HWIO_A2_DBG_FRAG0_LEN_ADDR A:0x64320af8
y.create.l HWIO_A2_DBG_FRAG1_LEN_ADDR A:0x64320afc
y.create.l HWIO_A2_DBG_FRAG2_LEN_ADDR A:0x64320b00
y.create.l HWIO_A2_DBG_FRAG3_LEN_ADDR A:0x64320b04
y.create.l HWIO_A2_DBG_FRAG4_LEN_ADDR A:0x64320b08
y.create.l HWIO_A2_DBG_FRAG0_ADDR_CUR_ADDR A:0x64320b0c
y.create.l HWIO_A2_DBG_FRAG1_ADDR_CUR_ADDR A:0x64320b10
y.create.l HWIO_A2_DBG_FRAG2_ADDR_CUR_ADDR A:0x64320b14
y.create.l HWIO_A2_DBG_FRAG3_ADDR_CUR_ADDR A:0x64320b18
y.create.l HWIO_A2_DBG_FRAG4_ADDR_CUR_ADDR A:0x64320b1c
y.create.l HWIO_A2_DBG_FRAG0_ADDR_NXT_ADDR A:0x64320b20
y.create.l HWIO_A2_DBG_FRAG1_ADDR_NXT_ADDR A:0x64320b24
y.create.l HWIO_A2_DBG_FRAG2_ADDR_NXT_ADDR A:0x64320b28
y.create.l HWIO_A2_DBG_FRAG3_ADDR_NXT_ADDR A:0x64320b2c
y.create.l HWIO_A2_DBG_FRAG4_ADDR_NXT_ADDR A:0x64320b30
y.create.l HWIO_A2_DBG_FRAG0_PTR_ADDR A:0x64320b34
y.create.l HWIO_A2_DBG_FRAG1_PTR_ADDR A:0x64320b38
y.create.l HWIO_A2_DBG_FRAG2_PTR_ADDR A:0x64320b3c
y.create.l HWIO_A2_DBG_FRAG3_PTR_ADDR A:0x64320b40
y.create.l HWIO_A2_DBG_FRAG4_PTR_ADDR A:0x64320b44
y.create.l HWIO_A2_DBG_TRBLK_LENGTH_ADDR A:0x64320b60
y.create.l HWIO_A2_DBG_TRBLK_START_ADDR_ADDR A:0x64320b64
y.create.l HWIO_A2_DBG_TRBLK_SW_INFO0_ADDR A:0x64320b68
y.create.l HWIO_A2_DBG_TRBLK_SW_INFO1_ADDR A:0x64320b6c
y.create.l HWIO_A2_DBG_TRBLK_TRIGGER_ADDR A:0x64320b70
y.create.l HWIO_A2_DBG_TRBLK_STATUS_ADDR A:0x64320b74
y.create.l HWIO_A2_DBG_STRM_ID_ADDR A:0x64320b80
y.create.l HWIO_A2_DBG_DMA_SRC_ADDR A:0x64320b84
y.create.l HWIO_A2_DBG_DMA_DST_ADDR A:0x64320b8c
y.create.l HWIO_A2_DBG_DMA_CTL_ADDR A:0x64320b90
y.create.l HWIO_A2_DBG_TASK_FETCHER_ADDR A:0x64320b94
y.create.l HWIO_A2_DBG_DL0_BAM_ADDR A:0x64320b98
y.create.l HWIO_A2_DBG_DL1_BAM_ADDR A:0x64320b9c
y.create.l HWIO_A2_DBG_DL2_BAM_ADDR A:0x64320ba0
y.create.l HWIO_A2_DBG_UL0_BAM_ADDR A:0x64320ba4
y.create.l HWIO_A2_DBG_UL1_BAM_ADDR A:0x64320ba8
y.create.l HWIO_A2_DBG_UL2_BAM_ADDR A:0x64320bac
y.create.l HWIO_A2_DBG_FRM_ADDR A:0x64320bb0
y.create.l HWIO_A2_DBG_DFRM_ADDR A:0x64320bb4
y.create.l HWIO_A2_DBG_CIPH_ADDR A:0x64320bb8
y.create.l HWIO_A2_DBG_IPF_ADDR A:0x64320bbc
y.create.l HWIO_A2_DBG_MIU0_ADDR A:0x64320bc0
y.create.l HWIO_A2_DBG_MIU1_ADDR A:0x64320bc4
y.create.l HWIO_A2_DBG_MIU2_ADDR A:0x64320bc8
y.create.l HWIO_A2_DBG_MIU3_ADDR A:0x64320bcc
y.create.l HWIO_A2_DBG_TASK_WORD_ADDR A:0x64320bd0
y.create.l HWIO_A2_DBG_UL_CKSUM0_ADDR A:0x64320bd4
y.create.l HWIO_A2_DBG_UL_CKSUM1_ADDR A:0x64320bd8
y.create.l HWIO_A2_DBG_DL_CKSUM0_ADDR A:0x64320bdc
y.create.l HWIO_A2_DBG_DL_CKSUM1_ADDR A:0x64320be0
y.create.l HWIO_A2_DBG_CKSUM_UL_EOT_ADDR A:0x64320be4
y.create.l HWIO_DBG_RESET_ADDR A:0x64320c00
y.create.l HWIO_DBG_ENABLE_ADDR A:0x64320c04
y.create.l HWIO_DBG_LOG_STATUS_ADDR A:0x64320c08
y.create.l HWIO_DBG_MUX_MASK_0_ADDR A:0x64320c0c
y.create.l HWIO_DBG_MUX_MASK_1_ADDR A:0x64320c10
y.create.l HWIO_DBG_MUX_MASK_2_ADDR A:0x64320c14
y.create.l HWIO_DBG_MUX_MASK_3_ADDR A:0x64320c18
y.create.l HWIO_DBG_MUX_MASK_4_ADDR A:0x64320c1c
y.create.l HWIO_DBG_MUX_MASK_5_ADDR A:0x64320c20
y.create.l HWIO_DBG_MUX_MASK_6_ADDR A:0x64320c24
y.create.l HWIO_DBG_MUX_MASK_7_ADDR A:0x64320c28
y.create.l HWIO_DBG_MUX_MASK_8_ADDR A:0x64320c2c
y.create.l HWIO_DBG_MUX_MASK_9_ADDR A:0x64320c30
y.create.l HWIO_DBG_PORT_MUX_ADDR A:0x64320c4c
y.create.l HWIO_DBG_ERR_IRQ_MASK0_ADDR A:0x64320c50
y.create.l HWIO_DBG_ERR_IRQ_MASK1_ADDR A:0x64320c54
y.create.l HWIO_DBG_SW_LOG_ADDR A:0x64320c58
y.create.l HWIO_DBG_DATA_DST_ADDR A:0x64320c5c
y.create.l HWIO_DBG_START_ADDR_ADDR A:0x64320c60
y.create.l HWIO_DBG_EXT_MEM_CNT_VAL_ADDR A:0x64320c64
y.create.l HWIO_DBG_SHRD_START_ADDR_ADDR A:0x64320c68
y.create.l HWIO_DBG_SHRD_END_ADDR_ADDR A:0x64320c6c
y.create.l HWIO_DBG_MAX_OST_BURSTS_ADDR A:0x64320c70
y.create.l HWIO_DBG_ERR_IRQ_EN0_ADDR A:0x64320c74
y.create.l HWIO_DBG_ERR_IRQ_EN1_ADDR A:0x64320c78
y.create.l HWIO_DBG_ERR_IRQ_CLR0_ADDR A:0x64320c7c
y.create.l HWIO_DBG_ERR_IRQ_CLR1_ADDR A:0x64320c80
y.create.l HWIO_DBG_ERR_IRQ_STATUS0_ADDR A:0x64320c84
y.create.l HWIO_DBG_ERR_IRQ_STATUS1_ADDR A:0x64320c88
y.create.l HWIO_MTC_BRDG_MCDMA_RD_ENABLE_ADDR A:0x6432100c
y.create.l HWIO_MTC_BRDG_MCDMA_WR_ENABLE_ADDR A:0x64321010
y.create.l HWIO_MTC_BRDG_A2_RD_ENABLE_ADDR A:0x64321014
y.create.l HWIO_MTC_BRDG_CTL_ADDR A:0x64321000
y.create.l HWIO_MTC_BRDG_STATUS_ADDR A:0x64321004
y.create.l HWIO_MTC_BRDG_CLEAR_ADDR A:0x64321008
y.create.l HWIO_A2_SHRD_MEM_BASE_MIN_ADDR A:0x64322000
y.create.l HWIO_A2_SHRD_MEM_BASE_MAX_ADDR A:0x6432367c
y.create.l HWIO_MCDMA_TS_STATUS_WORD0_ADDR A:0x64324000
y.create.l HWIO_MCDMA_TS_VBUF_CFG_WORD0_ADDR A:0x64324100
y.create.l HWIO_MCDMA_TS_VBUF_CFG_WORD1_ADDR A:0x64324104
y.create.l HWIO_MCDMA_TS_DMA_CH0_WORD0_ADDR A:0x64324200
y.create.l HWIO_MCDMA_TS_DMA_CH0_WORD1_ADDR A:0x64324204
y.create.l HWIO_MCDMA_TS_DMA_CH0_WORD2_ADDR A:0x64324208
y.create.l HWIO_MCDMA_TS_DMA_CH1_WORD0_ADDR A:0x64324300
y.create.l HWIO_MCDMA_TS_DMA_CH1_WORD1_ADDR A:0x64324304
y.create.l HWIO_MCDMA_TS_DMA_CH1_WORD2_ADDR A:0x64324308
y.create.l HWIO_MCDMA_TS_DMA_CH2_WORD0_ADDR A:0x64324400
y.create.l HWIO_MCDMA_TS_DMA_CH2_WORD1_ADDR A:0x64324404
y.create.l HWIO_MCDMA_TS_DMA_CH2_WORD2_ADDR A:0x64324408
y.create.l HWIO_MCDMA_TS_DMA_CH3_WORD0_ADDR A:0x64324500
y.create.l HWIO_MCDMA_TS_DMA_CH3_WORD1_ADDR A:0x64324504
y.create.l HWIO_MCDMA_TS_DMA_CH3_WORD2_ADDR A:0x64324508
y.create.l HWIO_DBG_STATUS_WORD0_ADDR A:0x64324800
y.create.l HWIO_DBG_TASK_WORD0_ADDR A:0x64324900
y.create.l HWIO_DBG_TASK_WORD1_ADDR A:0x64324904
y.create.l HWIO_UNIV_STMR_MSTMR_EXPY_ADDR A:0x64324c00
y.create.l HWIO_O_STMR_MSTMR_EXPY_ADDR A:0x64324c04
y.create.l HWIO_STMR_REF_COUNT_EXPY_ADDR A:0x64324c08
y.create.l HWIO_STMR_PROG_SNP_INT0_STATUS_ADDR A:0x64324c0c
y.create.l HWIO_STMR_PROG_SNP_INT1_STATUS_ADDR A:0x64324c10
y.create.l HWIO_STMR_PROG_SNP_INT0_CMD_ADDR A:0x64324c14
y.create.l HWIO_STMR_PROG_SNP_INT1_CMD_ADDR A:0x64324c18
y.create.l HWIO_STMR_PROG_SNP_INT0_SET_ADDR A:0x64324c1c
y.create.l HWIO_STMR_PROG_SNP_INT1_SET_ADDR A:0x64324c20
y.create.l HWIO_ENCRYPT_ACC_RESET_ADDR A:0x64325000
y.create.l HWIO_ENCRYPT_ACC_CGC_CTL_ADDR A:0x64325004
y.create.l HWIO_ENCRYPT_ACC_CGC_STATUS_ADDR A:0x64325008
y.create.l HWIO_GEA_CONFIG_0_ADDR A:0x6432500c
y.create.l HWIO_GEA_INPUT_ADDR A:0x64325010
y.create.l HWIO_GEA_KC_0_ADDR A:0x64325014
y.create.l HWIO_GEA_KC_1_ADDR A:0x64325018
y.create.l HWIO_AMBA_KEY_STRM_WORD0_RD_ADDR A:0x6432501c
y.create.l HWIO_AMBA_KEY_STRM_WORD1_RD_ADDR A:0x64325020
y.create.l HWIO_AMBA_KEY_STRM_WORD2_RD_ADDR A:0x64325024
y.create.l HWIO_AMBA_KEY_STRM_WORD3_RD_ADDR A:0x64325028
y.create.l HWIO_AMBA_KEY_STRM_WORD4_RD_ADDR A:0x6432502c
y.create.l HWIO_AMBA_KEY_STRM_WORD5_RD_ADDR A:0x64325030
y.create.l HWIO_AMBA_KEY_STRM_WORD6_RD_ADDR A:0x64325034
y.create.l HWIO_AMBA_KEY_STRM_WORD7_RD_ADDR A:0x64325038
y.create.l HWIO_AMBA_KEY_STRM_STATUS_ADDR A:0x6432503c
y.create.l HWIO_AFIVE_CONFIG_0_ADDR A:0x64325040
y.create.l HWIO_AFIVE_INPUT_ADDR A:0x64325044
y.create.l HWIO_AFIVE_KC_0_ADDR A:0x64325048
y.create.l HWIO_AFIVE_KC_1_ADDR A:0x6432504c
y.create.l HWIO_AFIVE_KEY_STRM_WORD0_RD_ADDR A:0x64325050
y.create.l HWIO_AFIVE_KEY_STRM_WORD1_RD_ADDR A:0x64325054
y.create.l HWIO_AFIVE_KEY_STRM_WORD2_RD_ADDR A:0x64325058
y.create.l HWIO_AFIVE_KEY_STRM_WORD3_RD_ADDR A:0x6432505c
y.create.l HWIO_AFIVE_KEY_STRM_WORD4_RD_ADDR A:0x64325060
y.create.l HWIO_AFIVE_KEY_STRM_WORD5_RD_ADDR A:0x64325064
y.create.l HWIO_AFIVE_KEY_STRM_WORD6_RD_ADDR A:0x64325068
y.create.l HWIO_AFIVE_KEY_STRM_WORD7_RD_ADDR A:0x6432506c
y.create.l HWIO_AFIVE_KEY_STRM_WORD8_RD_ADDR A:0x64325070
y.create.l HWIO_AFIVE_KEY_STRM_WORD9_RD_ADDR A:0x64325074
y.create.l HWIO_O_STMR_RESET_ADDR A:0x64328000
y.create.l HWIO_O_STMR_ST_EVENT_CTL_ADDR A:0x64328004
y.create.l HWIO_O_STMR_FCW_ADDR A:0x64328008
y.create.l HWIO_O_STMR_MASK_CTL_ADDR A:0x6432800c
y.create.l HWIO_O_STMR_ENABLE_ADDR A:0x64328010
y.create.l HWIO_O_STMR_TIMER_CMD_ADDR A:0x64328014
y.create.l HWIO_O_STMR_MSTMR_ADDR A:0x64328018
y.create.l HWIO_O_STMR_MSTMR_PHASE_ADDR A:0x64328098
y.create.l HWIO_O_STMR_MSTMR_LD_VALUE_ADDR A:0x6432801c
y.create.l HWIO_O_STMR_MSTMR_WRAP_ADDR A:0x64328020
y.create.l HWIO_O_STMR_STROBE_CTL_0_ADDR A:0x64328024
y.create.l HWIO_O_STMR_STROBE_CTL_1_ADDR A:0x64328028
y.create.l HWIO_O_STMR_STROBE_CTL_2_ADDR A:0x6432802c
y.create.l HWIO_O_STMR_STROBE_CTL_3_ADDR A:0x64328030
y.create.l HWIO_O_STMR_STROBE_CTL_4_ADDR A:0x64328034
y.create.l HWIO_O_STMR_STROBE_CTL_5_ADDR A:0x64328038
y.create.l HWIO_O_STMR_STROBE_CTL_6_ADDR A:0x6432803c
y.create.l HWIO_O_STMR_STROBE_CTL_7_ADDR A:0x64328040
y.create.l HWIO_O_STMR_STROBE_CTL_8_ADDR A:0x64328044
y.create.l HWIO_O_STMR_STROBE_CTL_9_ADDR A:0x64328048
y.create.l HWIO_O_STMR_INT0_STATUS_ADDR A:0x64328064
y.create.l HWIO_O_STMR_INT0_CLR_ADDR A:0x64328068
y.create.l HWIO_O_STMR_INT1_STATUS_ADDR A:0x6432806c
y.create.l HWIO_O_STMR_INT1_CLR_ADDR A:0x64328070
y.create.l HWIO_O_STMR_STATUS_DUMP_CMD_ADDR A:0x64328074
y.create.l HWIO_O_STMR_MSTMR_STATUS_ADDR A:0x64328078
y.create.l HWIO_O_STMR_MSTMR_PHASE_STATUS_ADDR A:0x6432807c
y.create.l HWIO_TDS_STMR_ENABLE_ADDR A:0x64328400
y.create.l HWIO_TDS_STMR_STATUS_ADDR A:0x64328404
y.create.l HWIO_TDS_STMR_FCW_CTL_ADDR A:0x64328408
y.create.l HWIO_TDS_STMR_RESET_ADDR A:0x6432840c
y.create.l HWIO_TDS_STMR_ST_EVENT_CMD_ADDR A:0x64328410
y.create.l HWIO_TDS_STMR_ST_EVENT_TIME_ADDR A:0x64328414
y.create.l HWIO_TDS_STMR_WALLTIME_COUNT_ADDR A:0x64328418
y.create.l HWIO_TDS_STMR_COMMON_PHASE_ADDR A:0x6432841c
y.create.l HWIO_TDS_STMR_WALLTIME_CMD_ADDR A:0x64328420
y.create.l HWIO_TDS_STMR_WALL_TIME_MODIFIER_ADDR A:0x64328424
y.create.l HWIO_TDS_STMR_WALLTIME_INT_EVENT_0_ADDR A:0x64328428
y.create.l HWIO_TDS_STMR_WALLTIME_INT_EVENT_1_ADDR A:0x6432842c
y.create.l HWIO_TDS_STMR_WALLTIME_INT_EVENT_2_ADDR A:0x64328430
y.create.l HWIO_TDS_STMR_WALLTIME_INT_EVENT_3_ADDR A:0x64328434
y.create.l HWIO_TDS_STMR_WALLTIME_INT_EVENT_4_ADDR A:0x64328438
y.create.l HWIO_TDS_STMR_WALLTIME_INT_EVENT_5_ADDR A:0x6432843c
y.create.l HWIO_TDS_STMR_WALLTIME_INT_EVENT_6_ADDR A:0x64328440
y.create.l HWIO_TDS_STMR_WALLTIME_INT_EVENT_7_ADDR A:0x64328444
y.create.l HWIO_TDS_STMR_WALLTIME_INT_CMD_ADDR A:0x64328448
y.create.l HWIO_TDS_STMR_WALLTIME_INT_STATUS_ADDR A:0x6432844c
y.create.l HWIO_TDS_STMR_RXTIME_COUNT_ADDR A:0x64328450
y.create.l HWIO_TDS_STMR_RXTIME_CMD_ADDR A:0x64328454
y.create.l HWIO_TDS_STMR_RX_TIME_MODIFIER_ADDR A:0x64328458
y.create.l HWIO_TDS_STMR_RXTIME_INT_EVENT_0_ADDR A:0x6432845c
y.create.l HWIO_TDS_STMR_RXTIME_INT_EVENT_1_ADDR A:0x64328460
y.create.l HWIO_TDS_STMR_RXTIME_INT_EVENT_2_ADDR A:0x64328464
y.create.l HWIO_TDS_STMR_RXTIME_INT_EVENT_3_ADDR A:0x64328468
y.create.l HWIO_TDS_STMR_RXTIME_INT_EVENT_4_ADDR A:0x6432846c
y.create.l HWIO_TDS_STMR_RXTIME_INT_EVENT_5_ADDR A:0x64328470
y.create.l HWIO_TDS_STMR_RXTIME_INT_EVENT_6_ADDR A:0x64328474
y.create.l HWIO_TDS_STMR_RXTIME_INT_EVENT_7_ADDR A:0x64328478
y.create.l HWIO_TDS_STMR_RXTIME_INT_EVENT_8_ADDR A:0x6432847c
y.create.l HWIO_TDS_STMR_RXTIME_INT_EVENT_9_ADDR A:0x64328480
y.create.l HWIO_TDS_STMR_RXTIME_INT_STATUS_ADDR A:0x6432849c
y.create.l HWIO_TDS_STMR_RXTIME_INT_CMD_ADDR A:0x643284a0
y.create.l HWIO_TDS_STMR_STATUS_DUMP_CMD_ADDR A:0x643284a4
y.create.l HWIO_TDS_STMR_WALLTIME_COUNT_STATUS_ADDR A:0x643284a8
y.create.l HWIO_TDS_STMR_COMMON_PHASE_STATUS_ADDR A:0x643284ac
y.create.l HWIO_TDS_STMR_RXTIME_COUNT_STATUS_ADDR A:0x643284b0
y.create.l HWIO_TDS_STMR_TIME_SYNC_CTL_ADDR A:0x643284b4
y.create.l HWIO_VFR_EVENT_ADDR A:0x643284e8
y.create.l HWIO_UNIV_STMR_RESET_ADDR A:0x64328800
y.create.l HWIO_UNIV_STMR_ENABLE_ADDR A:0x64328804
y.create.l HWIO_UNIV_STMR_MSTMR_ADDR A:0x64328808
y.create.l HWIO_UNIV_STMR_SYNC_CMD_ADDR A:0x6432880c
y.create.l HWIO_UNIV_STMR_MODIFIER_ADJ_ADDR A:0x64328810
y.create.l HWIO_UNIV_STMR_STATUS_ADDR A:0x64328814
y.create.l HWIO_SYS_ONLINE_CTRL0_ADDR A:0x64328a00
y.create.l HWIO_SYS_ONLINE_CTRL1_ADDR A:0x64328a04
y.create.l HWIO_SYS_ONLINE_CTRL2_ADDR A:0x64328a08
y.create.l HWIO_SYS_ONLINE_CMD0_ADDR A:0x64328a10
y.create.l HWIO_SYS_ONLINE_CMD1_ADDR A:0x64328a14
y.create.l HWIO_SYS_ONLINE_CMD2_ADDR A:0x64328a18
y.create.l HWIO_SYS_ONLINE_TIME0_ADDR A:0x64328a20
y.create.l HWIO_SYS_ONLINE_TIME1_ADDR A:0x64328a24
y.create.l HWIO_SYS_ONLINE_TIME2_ADDR A:0x64328a28
y.create.l HWIO_SYS_ONLINE_STATUS_ADDR A:0x64328a30
y.create.l HWIO_UNIV_STMR_STATUS_DUMP_CMD_ADDR A:0x64328834
y.create.l HWIO_UNIV_STMR_TIME_STATUS_RD_ADDR A:0x64328838
y.create.l HWIO_O_STMR_TIME_STATUS_RD_ADDR A:0x6432883c
y.create.l HWIO_O_STMR_PHASE_STATUS_RD_ADDR A:0x64328840
y.create.l HWIO_UMTS_STMR_TIME_STATUS_RD_ADDR A:0x64328860
y.create.l HWIO_UMTS_TX_TIME_STATUS_RD_ADDR A:0x64328864
y.create.l HWIO_UMTS_STMR_PHASE_STATUS_RD_ADDR A:0x64328868
y.create.l HWIO_TDS_WALLTIME_STATUS_RD_ADDR A:0x6432886c
y.create.l HWIO_TDS_RXTIME_STATUS_RD_ADDR A:0x64328870
y.create.l HWIO_TDS_PHASE_STATUS_RD_ADDR A:0x64328874
y.create.l HWIO_TX_C0_CTRL_SEL_ADDR A:0x64328880
y.create.l HWIO_TX_C1_CTRL_SEL_ADDR A:0x64328884
y.create.l HWIO_TX_C0_TRIG_CMD_ADDR A:0x64328888
y.create.l HWIO_TX_C1_TRIG_CMD_ADDR A:0x6432888c
y.create.l HWIO_TX_C0_TRIG_VAL_ADDR A:0x64328890
y.create.l HWIO_TX_C1_TRIG_VAL_ADDR A:0x64328894
y.create.l HWIO_TX_TRIG_STATUS_ADDR A:0x643288a8
y.create.l HWIO_TX_C0_TRIG_RD_ADDR A:0x643288b0
y.create.l HWIO_TX_C1_TRIG_RD_ADDR A:0x643288b4
y.create.l HWIO_UNIV_STMR_TX_SYNC_TIME0_ADDR A:0x643288d0
y.create.l HWIO_UNIV_STMR_TX_SYNC_TIME1_ADDR A:0x643288d4
y.create.l HWIO_UNIV_STMR_TRIG_CTRL_ADDR A:0x643288d8
y.create.l HWIO_UNIV_STMR_TRIG_MASK_ADDR A:0x643288dc
y.create.l HWIO_VFR_SEL_ADDR A:0x643288e0
y.create.l HWIO_VFR_SEL_1_ADDR A:0x64328904
y.create.l HWIO_UNIV_STMR_SPARE_ADDR A:0x643288e4
y.create.l HWIO_SYS_SLEEP_STATUS_ADDR A:0x643288e8
y.create.l HWIO_UNIV_STMR_LD_CMD_ADDR A:0x643288ec
y.create.l HWIO_UNIV_STMR_MODIFIER_LD_ADDR A:0x643288f0
y.create.l HWIO_TX_DAC0_UPDATE_STRT_TRIG_CMD_ADDR A:0x64328908
y.create.l HWIO_TX_DAC1_UPDATE_STRT_TRIG_CMD_ADDR A:0x6432890c
y.create.l HWIO_TX_DAC0_UPDATE_STRT_VAL_ADDR A:0x64328910
y.create.l HWIO_TX_DAC1_UPDATE_STRT_VAL_ADDR A:0x64328914
y.create.l HWIO_TX_DAC0_UPDATE_STOP_TRIG_CMD_ADDR A:0x64328918
y.create.l HWIO_TX_DAC1_UPDATE_STOP_TRIG_CMD_ADDR A:0x6432891c
y.create.l HWIO_TX_DAC0_UPDATE_STOP_VAL_ADDR A:0x64328920
y.create.l HWIO_TX_DAC1_UPDATE_STOP_VAL_ADDR A:0x64328924
y.create.l HWIO_TX_DAC0_IREF_GAIN_ADDR A:0x64328928
y.create.l HWIO_TX_DAC1_IREF_GAIN_ADDR A:0x6432892c
y.create.l HWIO_DACCOMP_MUX_CHAIN0_STRT_TRIG_CMD_ADDR A:0x64328930
y.create.l HWIO_DACCOMP_MUX_CHAIN1_STRT_TRIG_CMD_ADDR A:0x64328934
y.create.l HWIO_DACCOMP_MUX_CHAIN0_STRT_VAL_ADDR A:0x64328938
y.create.l HWIO_DACCOMP_MUX_CHAIN1_STRT_VAL_ADDR A:0x6432893c
y.create.l HWIO_DACCOMP_MUX_CHAIN0_STOP_TRIG_CMD_ADDR A:0x64328940
y.create.l HWIO_DACCOMP_MUX_CHAIN1_STOP_TRIG_CMD_ADDR A:0x64328944
y.create.l HWIO_DACCOMP_MUX_CHAIN0_STOP_VAL_ADDR A:0x64328948
y.create.l HWIO_DACCOMP_MUX_CHAIN1_STOP_VAL_ADDR A:0x6432894c
y.create.l HWIO_DACCOMP_MUX_CHAIN0_STRT_TRIG_RD_ADDR A:0x64328950
y.create.l HWIO_DACCOMP_MUX_CHAIN1_STRT_TRIG_RD_ADDR A:0x64328954
y.create.l HWIO_DACCOMP_MUX_CHAIN0_STOP_TRIG_RD_ADDR A:0x64328958
y.create.l HWIO_DACCOMP_MUX_CHAIN1_STOP_TRIG_RD_ADDR A:0x6432895c
y.create.l HWIO_RXFE_C0_TRIG_CMD_ADDR A:0x64328980
y.create.l HWIO_RXFE_C1_TRIG_CMD_ADDR A:0x64328984
y.create.l HWIO_RXFE_C2_TRIG_CMD_ADDR A:0x64328988
y.create.l HWIO_RXFE_C3_TRIG_CMD_ADDR A:0x6432898c
y.create.l HWIO_RXFE_C0_TRIG_VAL_ADDR A:0x643289a0
y.create.l HWIO_RXFE_C1_TRIG_VAL_ADDR A:0x643289a4
y.create.l HWIO_RXFE_C2_TRIG_VAL_ADDR A:0x643289a8
y.create.l HWIO_RXFE_C3_TRIG_VAL_ADDR A:0x643289ac
y.create.l HWIO_RXFE_TRIG_STATUS_ADDR A:0x643289c0
y.create.l HWIO_RXFE_C0_TRIG_RD_ADDR A:0x643289d0
y.create.l HWIO_RXFE_C1_TRIG_RD_ADDR A:0x643289d4
y.create.l HWIO_RXFE_C2_TRIG_RD_ADDR A:0x643289d8
y.create.l HWIO_RXFE_C3_TRIG_RD_ADDR A:0x643289dc
y.create.l HWIO_STMR_TIME_RD_ADDR A:0x64328b00
y.create.l HWIO_STMR_EVT_MATCH_0_ADDR A:0x64328b04
y.create.l HWIO_STMR_EVT_MATCH_1_ADDR A:0x64328b08
y.create.l HWIO_STMR_EVT_MATCH_2_ADDR A:0x64328b0c
y.create.l HWIO_STMR_EVT_MATCH_3_ADDR A:0x64328b10
y.create.l HWIO_STMR_EVT_MATCH_4_ADDR A:0x64328b14
y.create.l HWIO_STMR_EVT_MATCH_5_ADDR A:0x64328b18
y.create.l HWIO_STMR_EVT_MATCH_6_ADDR A:0x64328b1c
y.create.l HWIO_STMR_EVT_MATCH_7_ADDR A:0x64328b20
y.create.l HWIO_STMR_EVT_MATCH_8_ADDR A:0x64328b24
y.create.l HWIO_STMR_EVT_MATCH_9_ADDR A:0x64328b28
y.create.l HWIO_UMTS_STMR_ENABLE_ADDR A:0x64329000
y.create.l HWIO_UMTS_STMR_STATUS_ADDR A:0x64329004
y.create.l HWIO_STMR_FCW_CTL_ADDR A:0x64329008
y.create.l HWIO_STMR_RESET_ADDR A:0x6432900c
y.create.l HWIO_STMR_ST_EVENT_CTL_ADDR A:0x64329010
y.create.l HWIO_STMR_TIME_CMD_PRI_ADDR A:0x64329014
y.create.l HWIO_STMR_WALL_TIME_MODIFIER_ADDR A:0x64329018
y.create.l HWIO_STMR_STATUS_DUMP_CMD_PRI_ADDR A:0x6432901c
y.create.l HWIO_STMR_REF_COUNT_STATUS_PRI_ADDR A:0x64329020
y.create.l HWIO_STMR_TX_TIME_STATUS_PRI_ADDR A:0x64329024
y.create.l HWIO_STMR_C0_COUNT_STATUS_ADDR A:0x64329028
y.create.l HWIO_STMR_C1_COUNT_STATUS_ADDR A:0x6432902c
y.create.l HWIO_STMR_C2_COUNT_STATUS_ADDR A:0x64329030
y.create.l HWIO_STMR_PHASE_PRI_ADDR A:0x64329038
y.create.l HWIO_STMR_REF_COUNT_ADDR A:0x6432903c
y.create.l HWIO_STMR_REF_PHASE_ADDR A:0x64329318
y.create.l HWIO_STMR_COMBINER_COUNT0_PRI_ADDR A:0x64329040
y.create.l HWIO_STMR_COMBINER_COUNT1_PRI_ADDR A:0x64329044
y.create.l HWIO_STMR_COMBINER_COUNT2_PRI_ADDR A:0x64329048
y.create.l HWIO_STMR_CFN_COUNT0_ADDR A:0x64329050
y.create.l HWIO_STMR_CFN_COUNT1_ADDR A:0x64329054
y.create.l HWIO_STMR_CFN_COUNT2_ADDR A:0x64329058
y.create.l HWIO_STMR_TIME_SYNC_CTL_ADDR A:0x64329060
y.create.l HWIO_STMR_CN_MODIFIER_ON_LINE_ADDR A:0x64329064
y.create.l HWIO_STMR_MISC_CTL_ADDR A:0x64329068
y.create.l HWIO_STMR_TX_10MS_INT_OFFSET_ADDR A:0x6432906c
y.create.l HWIO_STMR_PROG_INT0_STATUS_ADDR A:0x64329070
y.create.l HWIO_STMR_PROG_INT1_STATUS_ADDR A:0x64329074
y.create.l HWIO_STMR_PROG_INT2_STATUS_ADDR A:0x64329078
y.create.l HWIO_STMR_PROG_INT0_CMD_ADDR A:0x64329080
y.create.l HWIO_STMR_PROG_INT1_CMD_ADDR A:0x64329084
y.create.l HWIO_STMR_PROG_INT2_CMD_ADDR A:0x64329088
y.create.l HWIO_STMR_PROG_INT0_CTL_ADDR A:0x64329090
y.create.l HWIO_STMR_PROG_INT1_CTL_ADDR A:0x64329094
y.create.l HWIO_STMR_PROG_INT2_CTL_ADDR A:0x64329098
y.create.l HWIO_STMR_INT0_EVENT_0_ADDR A:0x643290a0
y.create.l HWIO_STMR_INT0_EVENT_1_ADDR A:0x643290a4
y.create.l HWIO_STMR_INT0_EVENT_2_ADDR A:0x643290a8
y.create.l HWIO_STMR_INT0_EVENT_3_ADDR A:0x643290ac
y.create.l HWIO_STMR_INT0_EVENT_4_ADDR A:0x643290b0
y.create.l HWIO_STMR_INT0_EVENT_5_ADDR A:0x643290b4
y.create.l HWIO_STMR_INT0_EVENT_6_ADDR A:0x643290b8
y.create.l HWIO_STMR_INT0_EVENT_7_ADDR A:0x643290bc
y.create.l HWIO_STMR_INT0_EVENT_8_ADDR A:0x643290c0
y.create.l HWIO_STMR_INT0_EVENT_9_ADDR A:0x643290c4
y.create.l HWIO_STMR_INT1_EVENT_0_ADDR A:0x643290e0
y.create.l HWIO_STMR_INT1_EVENT_1_ADDR A:0x643290e4
y.create.l HWIO_STMR_INT1_EVENT_2_ADDR A:0x643290e8
y.create.l HWIO_STMR_INT1_EVENT_3_ADDR A:0x643290ec
y.create.l HWIO_STMR_INT1_EVENT_4_ADDR A:0x643290f0
y.create.l HWIO_STMR_INT1_EVENT_5_ADDR A:0x643290f4
y.create.l HWIO_STMR_INT1_EVENT_6_ADDR A:0x643290f8
y.create.l HWIO_STMR_INT1_EVENT_7_ADDR A:0x643290fc
y.create.l HWIO_STMR_INT1_EVENT_8_ADDR A:0x64329100
y.create.l HWIO_STMR_INT1_EVENT_9_ADDR A:0x64329104
y.create.l HWIO_STMR_INT2_EVENT_0_ADDR A:0x64329120
y.create.l HWIO_STMR_INT2_EVENT_1_ADDR A:0x64329124
y.create.l HWIO_STMR_INT2_EVENT_2_ADDR A:0x64329128
y.create.l HWIO_STMR_INT2_EVENT_3_ADDR A:0x6432912c
y.create.l HWIO_STMR_INT2_EVENT_4_ADDR A:0x64329130
y.create.l HWIO_STMR_INT2_EVENT_5_ADDR A:0x64329134
y.create.l HWIO_STMR_INT2_EVENT_6_ADDR A:0x64329138
y.create.l HWIO_STMR_INT2_EVENT_7_ADDR A:0x6432913c
y.create.l HWIO_STMR_INT2_EVENT_8_ADDR A:0x64329140
y.create.l HWIO_STMR_INT2_EVENT_9_ADDR A:0x64329144
y.create.l HWIO_STMR_TIME_CMD_SNP_ADDR A:0x643291a0
y.create.l HWIO_STMR_TX_TARGET_REF_COUNT_ADDR A:0x643291ac
y.create.l HWIO_STMR_TX_TIME_MODIFIER_ADDR A:0x643291b0
y.create.l HWIO_STMR_COMBINER_CMD_SNP_ADDR A:0x643291b4
y.create.l HWIO_STMR_C0_TARGET_REF_COUNT_ADDR A:0x643291b8
y.create.l HWIO_STMR_C1_TARGET_REF_COUNT_ADDR A:0x643291bc
y.create.l HWIO_STMR_C2_TARGET_REF_COUNT_ADDR A:0x643291c0
y.create.l HWIO_STMR_CFN0_MODIFIER_ADDR A:0x64329308
y.create.l HWIO_STMR_CFN1_MODIFIER_ADDR A:0x6432930c
y.create.l HWIO_STMR_CFN2_MODIFIER_ADDR A:0x64329310
y.create.l HWIO_STMR_C0_MODIFIER_ADDR A:0x643291c8
y.create.l HWIO_STMR_C1_MODIFIER_ADDR A:0x643291cc
y.create.l HWIO_STMR_C2_MODIFIER_ADDR A:0x643291d0
y.create.l HWIO_STMR_STATUS_DUMP_CMD_SNP_ADDR A:0x643291d8
y.create.l HWIO_STMR_TX_TIME_STATUS_SNP_ADDR A:0x643291dc
y.create.l HWIO_STMR_REF_COUNT_STATUS_SNP_ADDR A:0x643291e0
y.create.l HWIO_STMR_PHASE_SNP_ADDR A:0x643291e8
y.create.l HWIO_STMR_TX_TIME_SNP_ADDR A:0x643291ec
y.create.l HWIO_STMR_PROG_SNP_INT0_CTL_ADDR A:0x64329218
y.create.l HWIO_STMR_PROG_SNP_INT1_CTL_ADDR A:0x6432921c
y.create.l HWIO_STMR_SNP_INT0_EVENT_0_ADDR A:0x64329224
y.create.l HWIO_STMR_SNP_INT0_EVENT_1_ADDR A:0x64329228
y.create.l HWIO_STMR_SNP_INT0_EVENT_2_ADDR A:0x6432922c
y.create.l HWIO_STMR_SNP_INT0_EVENT_3_ADDR A:0x64329230
y.create.l HWIO_STMR_SNP_INT0_EVENT_4_ADDR A:0x64329234
y.create.l HWIO_STMR_SNP_INT0_EVENT_5_ADDR A:0x64329238
y.create.l HWIO_STMR_SNP_INT0_EVENT_6_ADDR A:0x6432923c
y.create.l HWIO_STMR_SNP_INT0_EVENT_7_ADDR A:0x64329240
y.create.l HWIO_STMR_SNP_INT1_EVENT_0_ADDR A:0x64329264
y.create.l HWIO_STMR_SNP_INT1_EVENT_1_ADDR A:0x64329268
y.create.l HWIO_STMR_SNP_INT1_EVENT_2_ADDR A:0x6432926c
y.create.l HWIO_STMR_SNP_INT1_EVENT_3_ADDR A:0x64329270
y.create.l HWIO_OCIMEM_HW_VERSION_ADDR A:0x60050000
y.create.l HWIO_OCIMEM_HW_PROFILE_ADDR A:0x60050004
y.create.l HWIO_OCIMEM_GEN_CTL_ADDR A:0x60050008
y.create.l HWIO_OCIMEM_GEN_STAT_ADDR A:0x6005000c
y.create.l HWIO_OCIMEM_INTC_CLR_ADDR A:0x60050010
y.create.l HWIO_OCIMEM_INTC_MASK_ADDR A:0x60050014
y.create.l HWIO_OCIMEM_INTC_STAT_ADDR A:0x60050018
y.create.l HWIO_OCIMEM_OSW_STATUS_ADDR A:0x6005001c
y.create.l HWIO_OCIMEM_PSCGC_TIMERS_ADDR A:0x60050034
y.create.l HWIO_OCIMEM_PSCGC_STAT_ADDR A:0x60050038
y.create.l HWIO_OCIMEM_PSCGC_M0_M7_CTL_ADDR A:0x6005003c
y.create.l HWIO_OCIMEM_ERR_ADDRESS_ADDR A:0x60050060
y.create.l HWIO_OCIMEM_AXI_ERR_SYNDROME_ADDR A:0x60050064
y.create.l HWIO_OCIMEM_DEBUG_CTL_ADDR A:0x60050068
y.create.l HWIO_OCIMEM_MPU_XPU_SCR_ADDR A:0x60053000
y.create.l HWIO_OCIMEM_MPU_XPU_SWDR_ADDR A:0x60053004
y.create.l HWIO_OCIMEM_MPU_XPU_PRTN_RACR_SSHADOW_ADDR A:0x60053008
y.create.l HWIO_OCIMEM_MPU_XPU_PRTN_WACR_SSHADOW_ADDR A:0x6005300c
y.create.l HWIO_OCIMEM_MPU_XPU_PRTN_START_SSHADOW0_ADDR A:0x60053010
y.create.l HWIO_OCIMEM_MPU_XPU_PRTN_END_SSHADOW0_ADDR A:0x60053018
y.create.l HWIO_OCIMEM_MPU_XPU_SEAR0_ADDR A:0x60053040
y.create.l HWIO_OCIMEM_MPU_XPU_SESR_ADDR A:0x60053048
y.create.l HWIO_OCIMEM_MPU_XPU_SESRRESTORE_ADDR A:0x6005304c
y.create.l HWIO_OCIMEM_MPU_XPU_SESYNR0_ADDR A:0x60053050
y.create.l HWIO_OCIMEM_MPU_XPU_SESYNR1_ADDR A:0x60053054
y.create.l HWIO_OCIMEM_MPU_XPU_SESYNR2_ADDR A:0x60053058
y.create.l HWIO_OCIMEM_MPU_XPU_MCR_ADDR A:0x60053100
y.create.l HWIO_OCIMEM_MPU_XPU_MEAR0_ADDR A:0x60053140
y.create.l HWIO_OCIMEM_MPU_XPU_MESR_ADDR A:0x60053148
y.create.l HWIO_OCIMEM_MPU_XPU_MESRRESTORE_ADDR A:0x6005314c
y.create.l HWIO_OCIMEM_MPU_XPU_MESYNR0_ADDR A:0x60053150
y.create.l HWIO_OCIMEM_MPU_XPU_MESYNR1_ADDR A:0x60053154
y.create.l HWIO_OCIMEM_MPU_XPU_MESYNR2_ADDR A:0x60053158
y.create.l HWIO_OCIMEM_MPU_XPU_CR_ADDR A:0x60053080
y.create.l HWIO_OCIMEM_MPU_XPU_PRTN_RACR_SHADOW_ADDR A:0x60053088
y.create.l HWIO_OCIMEM_MPU_XPU_PRTN_WACR_SHADOW_ADDR A:0x6005308c
y.create.l HWIO_OCIMEM_MPU_XPU_PRTN_START_SHADOW0_ADDR A:0x60053090
y.create.l HWIO_OCIMEM_MPU_XPU_PRTN_END_SHADOW0_ADDR A:0x60053098
y.create.l HWIO_OCIMEM_MPU_XPU_RPU_ACR0_ADDR A:0x600530a0
y.create.l HWIO_OCIMEM_MPU_XPU_EAR0_ADDR A:0x600530c0
y.create.l HWIO_OCIMEM_MPU_XPU_ESR_ADDR A:0x600530c8
y.create.l HWIO_OCIMEM_MPU_XPU_ESRRESTORE_ADDR A:0x600530cc
y.create.l HWIO_OCIMEM_MPU_XPU_ESYNR0_ADDR A:0x600530d0
y.create.l HWIO_OCIMEM_MPU_XPU_ESYNR1_ADDR A:0x600530d4
y.create.l HWIO_OCIMEM_MPU_XPU_ESYNR2_ADDR A:0x600530d8
y.create.l HWIO_OCIMEM_MPU_XPU_UMR_RACR_ADDR A:0x600530e0
y.create.l HWIO_OCIMEM_MPU_XPU_UMR_WACR_ADDR A:0x600530e4
y.create.l HWIO_OCIMEM_MPU_XPU_UMR_CNTL_ADDR A:0x600530f0
y.create.l HWIO_OCIMEM_MPU_XPU_IDR0_ADDR A:0x60053074
y.create.l HWIO_OCIMEM_MPU_XPU_IDR1_ADDR A:0x60053078
y.create.l HWIO_OCIMEM_MPU_XPU_REV_ADDR A:0x6005307c
y.create.l HWIO_OCIMEM_MPU_XPU_PRT0_RACR0_ADDR A:0x60053200
y.create.l HWIO_OCIMEM_MPU_XPU_PRT1_RACR0_ADDR A:0x60053280
y.create.l HWIO_OCIMEM_MPU_XPU_PRT2_RACR0_ADDR A:0x60053300
y.create.l HWIO_OCIMEM_MPU_XPU_PRT3_RACR0_ADDR A:0x60053380
y.create.l HWIO_OCIMEM_MPU_XPU_PRT4_RACR0_ADDR A:0x60053400
y.create.l HWIO_OCIMEM_MPU_XPU_PRT5_RACR0_ADDR A:0x60053480
y.create.l HWIO_OCIMEM_MPU_XPU_PRT6_RACR0_ADDR A:0x60053500
y.create.l HWIO_OCIMEM_MPU_XPU_PRT7_RACR0_ADDR A:0x60053580
y.create.l HWIO_OCIMEM_MPU_XPU_PRT0_WACR0_ADDR A:0x60053220
y.create.l HWIO_OCIMEM_MPU_XPU_PRT1_WACR0_ADDR A:0x600532a0
y.create.l HWIO_OCIMEM_MPU_XPU_PRT2_WACR0_ADDR A:0x60053320
y.create.l HWIO_OCIMEM_MPU_XPU_PRT3_WACR0_ADDR A:0x600533a0
y.create.l HWIO_OCIMEM_MPU_XPU_PRT4_WACR0_ADDR A:0x60053420
y.create.l HWIO_OCIMEM_MPU_XPU_PRT5_WACR0_ADDR A:0x600534a0
y.create.l HWIO_OCIMEM_MPU_XPU_PRT6_WACR0_ADDR A:0x60053520
y.create.l HWIO_OCIMEM_MPU_XPU_PRT7_WACR0_ADDR A:0x600535a0
y.create.l HWIO_OCIMEM_MPU_XPU_PRT0_START0_ADDR A:0x60053240
y.create.l HWIO_OCIMEM_MPU_XPU_PRT1_START0_ADDR A:0x600532c0
y.create.l HWIO_OCIMEM_MPU_XPU_PRT2_START0_ADDR A:0x60053340
y.create.l HWIO_OCIMEM_MPU_XPU_PRT3_START0_ADDR A:0x600533c0
y.create.l HWIO_OCIMEM_MPU_XPU_PRT4_START0_ADDR A:0x60053440
y.create.l HWIO_OCIMEM_MPU_XPU_PRT5_START0_ADDR A:0x600534c0
y.create.l HWIO_OCIMEM_MPU_XPU_PRT6_START0_ADDR A:0x60053540
y.create.l HWIO_OCIMEM_MPU_XPU_PRT7_START0_ADDR A:0x600535c0
y.create.l HWIO_OCIMEM_MPU_XPU_PRT0_END0_ADDR A:0x60053248
y.create.l HWIO_OCIMEM_MPU_XPU_PRT1_END0_ADDR A:0x600532c8
y.create.l HWIO_OCIMEM_MPU_XPU_PRT2_END0_ADDR A:0x60053348
y.create.l HWIO_OCIMEM_MPU_XPU_PRT3_END0_ADDR A:0x600533c8
y.create.l HWIO_OCIMEM_MPU_XPU_PRT4_END0_ADDR A:0x60053448
y.create.l HWIO_OCIMEM_MPU_XPU_PRT5_END0_ADDR A:0x600534c8
y.create.l HWIO_OCIMEM_MPU_XPU_PRT6_END0_ADDR A:0x60053548
y.create.l HWIO_OCIMEM_MPU_XPU_PRT7_END0_ADDR A:0x600535c8
y.create.l HWIO_OCIMEM_MPU_XPU_PRT0_SCR_ADDR A:0x60053250
y.create.l HWIO_OCIMEM_MPU_XPU_PRT1_SCR_ADDR A:0x600532d0
y.create.l HWIO_OCIMEM_MPU_XPU_PRT2_SCR_ADDR A:0x60053350
y.create.l HWIO_OCIMEM_MPU_XPU_PRT3_SCR_ADDR A:0x600533d0
y.create.l HWIO_OCIMEM_MPU_XPU_PRT4_SCR_ADDR A:0x60053450
y.create.l HWIO_OCIMEM_MPU_XPU_PRT5_SCR_ADDR A:0x600534d0
y.create.l HWIO_OCIMEM_MPU_XPU_PRT6_SCR_ADDR A:0x60053550
y.create.l HWIO_OCIMEM_MPU_XPU_PRT7_SCR_ADDR A:0x600535d0
y.create.l HWIO_OCIMEM_MPU_XPU_PRT0_MCR_ADDR A:0x60053254
y.create.l HWIO_OCIMEM_MPU_XPU_PRT1_MCR_ADDR A:0x600532d4
y.create.l HWIO_OCIMEM_MPU_XPU_PRT2_MCR_ADDR A:0x60053354
y.create.l HWIO_OCIMEM_MPU_XPU_PRT3_MCR_ADDR A:0x600533d4
y.create.l HWIO_OCIMEM_MPU_XPU_PRT4_MCR_ADDR A:0x60053454
y.create.l HWIO_OCIMEM_MPU_XPU_PRT5_MCR_ADDR A:0x600534d4
y.create.l HWIO_OCIMEM_MPU_XPU_PRT6_MCR_ADDR A:0x60053554
y.create.l HWIO_OCIMEM_MPU_XPU_PRT7_MCR_ADDR A:0x600535d4
y.create.l HWIO_OCIMEM_MPU_XPU_PRT0_CNTL0_ADDR A:0x60053258
y.create.l HWIO_OCIMEM_MPU_XPU_PRT1_CNTL0_ADDR A:0x600532d8
y.create.l HWIO_OCIMEM_MPU_XPU_PRT2_CNTL0_ADDR A:0x60053358
y.create.l HWIO_OCIMEM_MPU_XPU_PRT3_CNTL0_ADDR A:0x600533d8
y.create.l HWIO_OCIMEM_MPU_XPU_PRT4_CNTL0_ADDR A:0x60053458
y.create.l HWIO_OCIMEM_MPU_XPU_PRT5_CNTL0_ADDR A:0x600534d8
y.create.l HWIO_OCIMEM_MPU_XPU_PRT6_CNTL0_ADDR A:0x60053558
y.create.l HWIO_OCIMEM_MPU_XPU_PRT7_CNTL0_ADDR A:0x600535d8
y.create.l HWIO_OCIMEM_MPU_XPU_PRT0_CNTL1_ADDR A:0x6005325c
y.create.l HWIO_OCIMEM_MPU_XPU_PRT1_CNTL1_ADDR A:0x600532dc
y.create.l HWIO_OCIMEM_MPU_XPU_PRT2_CNTL1_ADDR A:0x6005335c
y.create.l HWIO_OCIMEM_MPU_XPU_PRT3_CNTL1_ADDR A:0x600533dc
y.create.l HWIO_OCIMEM_MPU_XPU_PRT4_CNTL1_ADDR A:0x6005345c
y.create.l HWIO_OCIMEM_MPU_XPU_PRT5_CNTL1_ADDR A:0x600534dc
y.create.l HWIO_OCIMEM_MPU_XPU_PRT6_CNTL1_ADDR A:0x6005355c
y.create.l HWIO_OCIMEM_MPU_XPU_PRT7_CNTL1_ADDR A:0x600535dc
y.create.l HWIO_OXILI_RBBM_HW_VERSION_ADDR A:0x61c00000
y.create.l HWIO_OXILI_RBBM_HW_RELEASE_ADDR A:0x61c00004
y.create.l HWIO_OXILI_RBBM_HW_CONFIGURATION_ADDR A:0x61c00008
y.create.l HWIO_OXILI_RBBM_CLOCK_CTL_ADDR A:0x61c00040
y.create.l HWIO_OXILI_RBBM_CLOCK_CTL1_ADDR A:0x61c0004c
y.create.l HWIO_OXILI_RBBM_CLOCK_STATUS_ADDR A:0x61c00044
y.create.l HWIO_OXILI_RBBM_SP_HYST_CNT_ADDR A:0x61c00048
y.create.l HWIO_OXILI_RBBM_SW_RESET_CMD_ADDR A:0x61c00060
y.create.l HWIO_OXILI_RBBM_AHB_CTL0_ADDR A:0x61c00080
y.create.l HWIO_OXILI_RBBM_AHB_CTL1_ADDR A:0x61c00084
y.create.l HWIO_OXILI_RBBM_AHB_CMD_ADDR A:0x61c00088
y.create.l HWIO_OXILI_RBBM_AHB_STATUS_ADDR A:0x61c0008c
y.create.l HWIO_OXILI_RBBM_AHB_TXFR_TIMEOUT_STATUS_ADDR A:0x61c00090
y.create.l HWIO_OXILI_RBBM_AHB_ME_SPLIT_STATUS_ADDR A:0x61c00094
y.create.l HWIO_OXILI_RBBM_AHB_PFP_SPLIT_STATUS_ADDR A:0x61c00098
y.create.l HWIO_OXILI_RBBM_AHB_ERROR_STATUS_ADDR A:0x61c0009c
y.create.l HWIO_OXILI_RBBM_RB_SUB_BLOCK_SEL_CTL_ADDR A:0x61c000a4
y.create.l HWIO_OXILI_RBBM_GFX_COPY_CMD_ADDR A:0x61c000a8
y.create.l HWIO_OXILI_RBBM_GFX_COPY_STATUS_ADDR A:0x61c000ac
y.create.l HWIO_OXILI_RBBM_RAM_ACC_63_32_ADDR A:0x61c000b4
y.create.l HWIO_OXILI_RBBM_GPR0_CTL_ADDR A:0x61c000b8
y.create.l HWIO_OXILI_RBBM_GPR1_CTL_ADDR A:0x61c000bc
y.create.l HWIO_OXILI_RBBM_STATUS_ADDR A:0x61c000c0
y.create.l HWIO_OXILI_RBBM_STATUS1_ADDR A:0x61c000c4
y.create.l HWIO_OXILI_RBBM_STATUS2_ADDR A:0x61c000c8
y.create.l HWIO_OXILI_RBBM_WAIT_IDLE_CLOCKS_CTL_ADDR A:0x61c000cc
y.create.l HWIO_OXILI_RBBM_WAIT_FOR_GPU_IDLE_CMD_ADDR A:0x61c00100
y.create.l HWIO_OXILI_RBBM_WAIT_UNTIL_CMD_ADDR A:0x61c00104
y.create.l HWIO_OXILI_RBBM_WAIT_UNTIL_CTL_ADDR A:0x61c00108
y.create.l HWIO_OXILI_RBBM_INTERFACE_HANG_INT_CTL_ADDR A:0x61c00140
y.create.l HWIO_OXILI_RBBM_INTERFACE_HANG_MASK_CTL0_ADDR A:0x61c00144
y.create.l HWIO_OXILI_RBBM_INTERFACE_HANG_MASK_CTL1_ADDR A:0x61c00150
y.create.l HWIO_OXILI_RBBM_INTERFACE_HANG_MASK_CTL2_ADDR A:0x61c0015c
y.create.l HWIO_OXILI_RBBM_INTERFACE_HANG_MASK_CTL3_ADDR A:0x61c00168
y.create.l HWIO_OXILI_RBBM_INTERFACE_SRDY_STATUS0_ADDR A:0x61c00148
y.create.l HWIO_OXILI_RBBM_INTERFACE_SRDY_STATUS1_ADDR A:0x61c00154
y.create.l HWIO_OXILI_RBBM_INTERFACE_SRDY_STATUS2_ADDR A:0x61c00160
y.create.l HWIO_OXILI_RBBM_INTERFACE_SRDY_STATUS3_ADDR A:0x61c0016c
y.create.l HWIO_OXILI_RBBM_INTERFACE_RRDY_STATUS0_ADDR A:0x61c0014c
y.create.l HWIO_OXILI_RBBM_INTERFACE_RRDY_STATUS1_ADDR A:0x61c00158
y.create.l HWIO_OXILI_RBBM_INTERFACE_RRDY_STATUS2_ADDR A:0x61c00164
y.create.l HWIO_OXILI_RBBM_INTERFACE_RRDY_STATUS3_ADDR A:0x61c00170
y.create.l HWIO_OXILI_RBBM_INT_SET_CMD_ADDR A:0x61c00180
y.create.l HWIO_OXILI_RBBM_INT_CLEAR_CMD_ADDR A:0x61c00184
y.create.l HWIO_OXILI_RBBM_INT_UNMASKED_STATUS_ADDR A:0x61c00188
y.create.l HWIO_OXILI_RBBM_INT_0_MASK_ADDR A:0x61c0018c
y.create.l HWIO_OXILI_RBBM_INT_0_STATUS_ADDR A:0x61c00190
y.create.l HWIO_OXILI_RBBM_INT_1_MASK_CTL_ADDR A:0x61c00194
y.create.l HWIO_OXILI_RBBM_INT_1_STATUS_ADDR A:0x61c00198
y.create.l HWIO_OXILI_RBBM_INT_2_MASK_ADDR A:0x61c0019c
y.create.l HWIO_OXILI_RBBM_INT_2_STATUS_ADDR A:0x61c001a0
y.create.l HWIO_OXILI_RBBM_INT_3_MASK_ADDR A:0x61c001a4
y.create.l HWIO_OXILI_RBBM_INT_3_STATUS_ADDR A:0x61c001a8
y.create.l HWIO_OXILI_RBBM_INT_4_MASK_ADDR A:0x61c001ac
y.create.l HWIO_OXILI_RBBM_INT_4_STATUS_ADDR A:0x61c001b0
y.create.l HWIO_OXILI_RBBM_PERFCTR_CTL_ADDR A:0x61c00200
y.create.l HWIO_OXILI_RBBM_PERFCTR_LOAD_CMD0_ADDR A:0x61c00204
y.create.l HWIO_OXILI_RBBM_PERFCTR_LOAD_CMD1_ADDR A:0x61c00208
y.create.l HWIO_OXILI_RBBM_PERFCTR_LOAD_VALUE_LO_ADDR A:0x61c00210
y.create.l HWIO_OXILI_RBBM_PERFCTR_LOAD_VALUE_HI_ADDR A:0x61c00214
y.create.l HWIO_OXILI_RBBM_PERFCTR_RBBM_0_SEL_ADDR A:0x61c00218
y.create.l HWIO_OXILI_RBBM_PERFCTR_RBBM_1_SEL_ADDR A:0x61c0021c
y.create.l HWIO_OXILI_RBBM_GPU_BUSY_MAKSED_ADDR A:0x61c00220
y.create.l HWIO_OXILI_RBBM_PERFCTR_CP_0_LO_ADDR A:0x61c00240
y.create.l HWIO_OXILI_RBBM_PERFCTR_CP_0_HI_ADDR A:0x61c00244
y.create.l HWIO_OXILI_RBBM_PERFCTR_RBBM_0_LO_ADDR A:0x61c00248
y.create.l HWIO_OXILI_RBBM_PERFCTR_RBBM_0_HI_ADDR A:0x61c0024c
y.create.l HWIO_OXILI_RBBM_PERFCTR_RBBM_1_LO_ADDR A:0x61c00250
y.create.l HWIO_OXILI_RBBM_PERFCTR_RBBM_1_HI_ADDR A:0x61c00254
y.create.l HWIO_OXILI_RBBM_PERFCTR_PC_0_LO_ADDR A:0x61c00258
y.create.l HWIO_OXILI_RBBM_PERFCTR_PC_0_HI_ADDR A:0x61c0025c
y.create.l HWIO_OXILI_RBBM_PERFCTR_PC_1_LO_ADDR A:0x61c00260
y.create.l HWIO_OXILI_RBBM_PERFCTR_PC_1_HI_ADDR A:0x61c00264
y.create.l HWIO_OXILI_RBBM_PERFCTR_PC_2_LO_ADDR A:0x61c00268
y.create.l HWIO_OXILI_RBBM_PERFCTR_PC_2_HI_ADDR A:0x61c0026c
y.create.l HWIO_OXILI_RBBM_PERFCTR_PC_3_LO_ADDR A:0x61c00270
y.create.l HWIO_OXILI_RBBM_PERFCTR_PC_3_HI_ADDR A:0x61c00274
y.create.l HWIO_OXILI_RBBM_PERFCTR_VFD_0_LO_ADDR A:0x61c00278
y.create.l HWIO_OXILI_RBBM_PERFCTR_VFD_0_HI_ADDR A:0x61c0027c
y.create.l HWIO_OXILI_RBBM_PERFCTR_VFD_1_LO_ADDR A:0x61c00280
y.create.l HWIO_OXILI_RBBM_PERFCTR_VFD_1_HI_ADDR A:0x61c00284
y.create.l HWIO_OXILI_RBBM_PERFCTR_HLSQ_0_LO_ADDR A:0x61c00288
y.create.l HWIO_OXILI_RBBM_PERFCTR_HLSQ_0_HI_ADDR A:0x61c0028c
y.create.l HWIO_OXILI_RBBM_PERFCTR_HLSQ_1_LO_ADDR A:0x61c00290
y.create.l HWIO_OXILI_RBBM_PERFCTR_HLSQ_1_HI_ADDR A:0x61c00294
y.create.l HWIO_OXILI_RBBM_PERFCTR_HLSQ_2_LO_ADDR A:0x61c00298
y.create.l HWIO_OXILI_RBBM_PERFCTR_HLSQ_2_HI_ADDR A:0x61c0029c
y.create.l HWIO_OXILI_RBBM_PERFCTR_HLSQ_3_LO_ADDR A:0x61c002a0
y.create.l HWIO_OXILI_RBBM_PERFCTR_HLSQ_3_HI_ADDR A:0x61c002a4
y.create.l HWIO_OXILI_RBBM_PERFCTR_HLSQ_4_LO_ADDR A:0x61c002a8
y.create.l HWIO_OXILI_RBBM_PERFCTR_HLSQ_4_HI_ADDR A:0x61c002ac
y.create.l HWIO_OXILI_RBBM_PERFCTR_HLSQ_5_LO_ADDR A:0x61c002b0
y.create.l HWIO_OXILI_RBBM_PERFCTR_HLSQ_5_HI_ADDR A:0x61c002b4
y.create.l HWIO_OXILI_RBBM_PERFCTR_VPC_0_LO_ADDR A:0x61c002b8
y.create.l HWIO_OXILI_RBBM_PERFCTR_VPC_0_HI_ADDR A:0x61c002bc
y.create.l HWIO_OXILI_RBBM_PERFCTR_VPC_1_LO_ADDR A:0x61c002c0
y.create.l HWIO_OXILI_RBBM_PERFCTR_VPC_1_HI_ADDR A:0x61c002c4
y.create.l HWIO_OXILI_RBBM_PERFCTR_TSE_0_LO_ADDR A:0x61c002c8
y.create.l HWIO_OXILI_RBBM_PERFCTR_TSE_0_HI_ADDR A:0x61c002cc
y.create.l HWIO_OXILI_RBBM_PERFCTR_TSE_1_LO_ADDR A:0x61c002d0
y.create.l HWIO_OXILI_RBBM_PERFCTR_TSE_1_HI_ADDR A:0x61c002d4
y.create.l HWIO_OXILI_RBBM_PERFCTR_RAS_0_LO_ADDR A:0x61c002d8
y.create.l HWIO_OXILI_RBBM_PERFCTR_RAS_0_HI_ADDR A:0x61c002dc
y.create.l HWIO_OXILI_RBBM_PERFCTR_RAS_1_LO_ADDR A:0x61c002e0
y.create.l HWIO_OXILI_RBBM_PERFCTR_RAS_1_HI_ADDR A:0x61c002e4
y.create.l HWIO_OXILI_RBBM_PERFCTR_UCHE_0_LO_ADDR A:0x61c002e8
y.create.l HWIO_OXILI_RBBM_PERFCTR_UCHE_0_HI_ADDR A:0x61c002ec
y.create.l HWIO_OXILI_RBBM_PERFCTR_UCHE_1_LO_ADDR A:0x61c002f0
y.create.l HWIO_OXILI_RBBM_PERFCTR_UCHE_1_HI_ADDR A:0x61c002f4
y.create.l HWIO_OXILI_RBBM_PERFCTR_UCHE_2_LO_ADDR A:0x61c002f8
y.create.l HWIO_OXILI_RBBM_PERFCTR_UCHE_2_HI_ADDR A:0x61c002fc
y.create.l HWIO_OXILI_RBBM_PERFCTR_UCHE_3_LO_ADDR A:0x61c00300
y.create.l HWIO_OXILI_RBBM_PERFCTR_UCHE_3_HI_ADDR A:0x61c00304
y.create.l HWIO_OXILI_RBBM_PERFCTR_UCHE_4_LO_ADDR A:0x61c00308
y.create.l HWIO_OXILI_RBBM_PERFCTR_UCHE_4_HI_ADDR A:0x61c0030c
y.create.l HWIO_OXILI_RBBM_PERFCTR_UCHE_5_LO_ADDR A:0x61c00310
y.create.l HWIO_OXILI_RBBM_PERFCTR_UCHE_5_HI_ADDR A:0x61c00314
y.create.l HWIO_OXILI_RBBM_PERFCTR_TP_0_LO_ADDR A:0x61c00318
y.create.l HWIO_OXILI_RBBM_PERFCTR_TP_0_HI_ADDR A:0x61c0031c
y.create.l HWIO_OXILI_RBBM_PERFCTR_TP_1_LO_ADDR A:0x61c00320
y.create.l HWIO_OXILI_RBBM_PERFCTR_TP_1_HI_ADDR A:0x61c00324
y.create.l HWIO_OXILI_RBBM_PERFCTR_TP_2_LO_ADDR A:0x61c00328
y.create.l HWIO_OXILI_RBBM_PERFCTR_TP_2_HI_ADDR A:0x61c0032c
y.create.l HWIO_OXILI_RBBM_PERFCTR_TP_3_LO_ADDR A:0x61c00330
y.create.l HWIO_OXILI_RBBM_PERFCTR_TP_3_HI_ADDR A:0x61c00334
y.create.l HWIO_OXILI_RBBM_PERFCTR_TP_4_LO_ADDR A:0x61c00338
y.create.l HWIO_OXILI_RBBM_PERFCTR_TP_4_HI_ADDR A:0x61c0033c
y.create.l HWIO_OXILI_RBBM_PERFCTR_TP_5_LO_ADDR A:0x61c00340
y.create.l HWIO_OXILI_RBBM_PERFCTR_TP_5_HI_ADDR A:0x61c00344
y.create.l HWIO_OXILI_RBBM_PERFCTR_SP_0_LO_ADDR A:0x61c00348
y.create.l HWIO_OXILI_RBBM_PERFCTR_SP_0_HI_ADDR A:0x61c0034c
y.create.l HWIO_OXILI_RBBM_PERFCTR_SP_1_LO_ADDR A:0x61c00350
y.create.l HWIO_OXILI_RBBM_PERFCTR_SP_1_HI_ADDR A:0x61c00354
y.create.l HWIO_OXILI_RBBM_PERFCTR_SP_2_LO_ADDR A:0x61c00358
y.create.l HWIO_OXILI_RBBM_PERFCTR_SP_2_HI_ADDR A:0x61c0035c
y.create.l HWIO_OXILI_RBBM_PERFCTR_SP_3_LO_ADDR A:0x61c00360
y.create.l HWIO_OXILI_RBBM_PERFCTR_SP_3_HI_ADDR A:0x61c00364
y.create.l HWIO_OXILI_RBBM_PERFCTR_SP_4_LO_ADDR A:0x61c00368
y.create.l HWIO_OXILI_RBBM_PERFCTR_SP_4_HI_ADDR A:0x61c0036c
y.create.l HWIO_OXILI_RBBM_PERFCTR_SP_5_LO_ADDR A:0x61c00370
y.create.l HWIO_OXILI_RBBM_PERFCTR_SP_5_HI_ADDR A:0x61c00374
y.create.l HWIO_OXILI_RBBM_PERFCTR_SP_6_LO_ADDR A:0x61c00378
y.create.l HWIO_OXILI_RBBM_PERFCTR_SP_6_HI_ADDR A:0x61c0037c
y.create.l HWIO_OXILI_RBBM_PERFCTR_SP_7_LO_ADDR A:0x61c00380
y.create.l HWIO_OXILI_RBBM_PERFCTR_SP_7_HI_ADDR A:0x61c00384
y.create.l HWIO_OXILI_RBBM_PERFCTR_RB_0_LO_ADDR A:0x61c00388
y.create.l HWIO_OXILI_RBBM_PERFCTR_RB_0_HI_ADDR A:0x61c0038c
y.create.l HWIO_OXILI_RBBM_PERFCTR_RB_1_LO_ADDR A:0x61c00390
y.create.l HWIO_OXILI_RBBM_PERFCTR_RB_1_HI_ADDR A:0x61c00394
y.create.l HWIO_OXILI_RBBM_RBBM_CTL_ADDR A:0x61c00400
y.create.l HWIO_OXILI_RBBM_PERFCTR_PWR_0_LO_ADDR A:0x61c003a8
y.create.l HWIO_OXILI_RBBM_PERFCTR_PWR_0_HI_ADDR A:0x61c003ac
y.create.l HWIO_OXILI_RBBM_PERFCTR_PWR_1_LO_ADDR A:0x61c003b0
y.create.l HWIO_OXILI_RBBM_PERFCTR_PWR_1_HI_ADDR A:0x61c003b4
y.create.l HWIO_OXILI_RBBM_AHB_DEBUG_CTL_ADDR A:0x61c00440
y.create.l HWIO_OXILI_RBBM_DEBUG_BUS_CTL_ADDR A:0x61c00444
y.create.l HWIO_OXILI_RBBM_DEBUG_BUS_DATA_STATUS_ADDR A:0x61c00448
y.create.l HWIO_OXILI_RBBM_DEBUG_BUS_EN_CTL0_ADDR A:0x61c0044c
y.create.l HWIO_OXILI_RBBM_DEBUG_BUS_EN_CTL1_ADDR A:0x61c00450
y.create.l HWIO_OXILI_RBBM_DEBUG_BUS_STB_CTL0_ADDR A:0x61c00454
y.create.l HWIO_OXILI_RBBM_DEBUG_BUS_STB_CTL1_ADDR A:0x61c00458
y.create.l HWIO_OXILI_RBBM_MISR_BUS_CTL_ADDR A:0x61c0045c
y.create.l HWIO_OXILI_RBBM_MISR_BUS_CNT_ADDR A:0x61c00460
y.create.l HWIO_OXILI_RBBM_MISR_SIG_LO_ADDR A:0x61c00464
y.create.l HWIO_OXILI_RBBM_MISR_SIG_HI_ADDR A:0x61c00468
y.create.l HWIO_OXILI_RBBM_MISR_BUS_STB_CTL0_ADDR A:0x61c0046c
y.create.l HWIO_OXILI_RBBM_MISR_BUS_STB_CTL1_ADDR A:0x61c00470
y.create.l HWIO_OXILI_RBBM_INT_TRACE_BUS_CTL_ADDR A:0x61c00474
y.create.l HWIO_OXILI_RBBM_EXT_TRACE_BUS_CTL_ADDR A:0x61c00478
y.create.l HWIO_OXILI_RBBM_EXT_TRACE_STOP_CNT_ADDR A:0x61c0047c
y.create.l HWIO_OXILI_RBBM_EXT_TRACE_START_CNT_ADDR A:0x61c00480
y.create.l HWIO_OXILI_RBBM_EXT_TRACE_PERIOD_CNT_ADDR A:0x61c00484
y.create.l HWIO_OXILI_RBBM_EXT_TRACE_CMD_ADDR A:0x61c00488
y.create.l HWIO_OXILI_RBBM_VBIF_DEBUG_CTL_ADDR A:0x61c0048c
y.create.l HWIO_OXILI_RBBM_VBIF_AXI_MN_HALTREQ_ADDR A:0x61c00490
y.create.l HWIO_OXILI_RBBM_VBIF_AXI_MN_HALTACK_ADDR A:0x61c00494
y.create.l HWIO_OXILI_CP_RB_BASE_ADDR A:0x61c00700
y.create.l HWIO_OXILI_CP_RB_CNTL_ADDR A:0x61c00704
y.create.l HWIO_OXILI_CP_RB_RPTR_ADDR_ADDR A:0x61c0070c
y.create.l HWIO_OXILI_CP_RB_RPTR_ADDR A:0x61c00710
y.create.l HWIO_OXILI_CP_RB_RPTR_WR_ADDR A:0x61c0071c
y.create.l HWIO_OXILI_CP_RB_WPTR_ADDR A:0x61c00714
y.create.l HWIO_OXILI_CP_IB1_BASE_ADDR A:0x61c01160
y.create.l HWIO_OXILI_CP_IB1_BUFSZ_ADDR A:0x61c01164
y.create.l HWIO_OXILI_CP_IB2_BASE_ADDR A:0x61c01168
y.create.l HWIO_OXILI_CP_IB2_BUFSZ_ADDR A:0x61c0116c
y.create.l HWIO_OXILI_CP_ST_BASE_ADDR A:0x61c01134
y.create.l HWIO_OXILI_CP_ST_BUFSZ_ADDR A:0x61c01138
y.create.l HWIO_OXILI_CP_QUEUE_THRESHOLDS_ADDR A:0x61c00754
y.create.l HWIO_OXILI_CP_MEQ_THRESHOLDS_ADDR A:0x61c00758
y.create.l HWIO_OXILI_CP_CSQ_AVAIL_ADDR A:0x61c0075c
y.create.l HWIO_OXILI_CP_STQ_AVAIL_ADDR A:0x61c00760
y.create.l HWIO_OXILI_CP_MEQ_AVAIL_ADDR A:0x61c00764
y.create.l HWIO_OXILI_CP_CSQ_RB_STAT_ADDR A:0x61c007f4
y.create.l HWIO_OXILI_CP_CSQ_IB1_STAT_ADDR A:0x61c007f8
y.create.l HWIO_OXILI_CP_CSQ_IB2_STAT_ADDR A:0x61c007fc
y.create.l HWIO_OXILI_CP_NON_PREFETCH_CNTRS_ADDR A:0x61c01100
y.create.l HWIO_OXILI_CP_STQ_ST_STAT_ADDR A:0x61c0110c
y.create.l HWIO_OXILI_CP_MEQ_STAT_ADDR A:0x61c0113c
y.create.l HWIO_OXILI_CP_MIU_TAG_STAT_ADDR A:0x61c01148
y.create.l HWIO_OXILI_CP_MEQ_ADDR_ADDR A:0x61c00768
y.create.l HWIO_OXILI_CP_MEQ_DATA_ADDR A:0x61c0076c
y.create.l HWIO_OXILI_CP_ROQ_ADDR_ADDR A:0x61c00730
y.create.l HWIO_OXILI_CP_ROQ_DATA_ADDR A:0x61c00734
y.create.l HWIO_OXILI_CP_WFI_PEND_CTR_ADDR A:0x61c007d4
y.create.l HWIO_OXILI_CP_ME_CNTL_ADDR A:0x61c007d8
y.create.l HWIO_OXILI_CP_ME_STATUS_ADDR A:0x61c007dc
y.create.l HWIO_OXILI_CP_ME_RAM_WADDR_ADDR A:0x61c007e0
y.create.l HWIO_OXILI_CP_ME_RAM_RADDR_ADDR A:0x61c007e4
y.create.l HWIO_OXILI_CP_ME_RAM_DATA_ADDR A:0x61c007e8
y.create.l HWIO_OXILI_CP_ME_RDADDR_ADDR A:0x61c007a8
y.create.l HWIO_OXILI_CP_DEBUG_ADDR A:0x61c007f0
y.create.l HWIO_OXILI_CP_ME_VS_EVENT_SRC_ADDR A:0x61c01800
y.create.l HWIO_OXILI_CP_ME_VS_EVENT_ADDR_ADDR A:0x61c01804
y.create.l HWIO_OXILI_CP_ME_VS_EVENT_DATA_ADDR A:0x61c01808
y.create.l HWIO_OXILI_CP_ME_PS_EVENT_SRC_ADDR A:0x61c01814
y.create.l HWIO_OXILI_CP_ME_PS_EVENT_ADDR_ADDR A:0x61c01818
y.create.l HWIO_OXILI_CP_ME_PS_EVENT_DATA_ADDR A:0x61c0181c
y.create.l HWIO_OXILI_CP_ME_CF_EVENT_SRC_ADDR A:0x61c01828
y.create.l HWIO_OXILI_CP_ME_CF_EVENT_ADDR_ADDR A:0x61c0182c
y.create.l HWIO_OXILI_CP_ME_CF_EVENT_DATA_ADDR A:0x61c01830
y.create.l HWIO_OXILI_CP_ME_NRT_ADDR_ADDR A:0x61c01834
y.create.l HWIO_OXILI_CP_ME_NRT_DATA_ADDR A:0x61c01838
y.create.l HWIO_OXILI_CP_ME_RB_DONE_SRC_ADDR A:0x61c01848
y.create.l HWIO_OXILI_CP_ME_RB_DONE_ADDR_ADDR A:0x61c0184c
y.create.l HWIO_OXILI_CP_ME_RB_DONE_DATA_ADDR A:0x61c01850
y.create.l HWIO_OXILI_CP_PFP_UCODE_ADDR_ADDR A:0x61c00724
y.create.l HWIO_OXILI_CP_PFP_UCODE_DATA_ADDR A:0x61c00728
y.create.l HWIO_OXILI_CP_PERFCOUNTER_SELECT_ADDR A:0x61c01114
y.create.l HWIO_OXILI_CP_BIN_MASK_LO_ADDR A:0x61c01150
y.create.l HWIO_OXILI_CP_BIN_MASK_HI_ADDR A:0x61c01154
y.create.l HWIO_OXILI_CP_BIN_SELECT_LO_ADDR A:0x61c01158
y.create.l HWIO_OXILI_CP_BIN_SELECT_HI_ADDR A:0x61c0115c
y.create.l HWIO_OXILI_CP_NV_FLAGS_0_ADDR A:0x61c007b8
y.create.l HWIO_OXILI_CP_NV_FLAGS_1_ADDR A:0x61c007bc
y.create.l HWIO_OXILI_CP_NV_FLAGS_2_ADDR A:0x61c007c0
y.create.l HWIO_OXILI_CP_NV_FLAGS_3_ADDR A:0x61c007c4
y.create.l HWIO_OXILI_CP_STATE_DEBUG_INDEX_ADDR A:0x61c007b0
y.create.l HWIO_OXILI_CP_STATE_DEBUG_DATA_ADDR A:0x61c007b4
y.create.l HWIO_OXILI_CP_STAT_ADDR A:0x61c011fc
y.create.l HWIO_OXILI_CP_ECO_CTRL_ADDR A:0x61c011f0
y.create.l HWIO_OXILI_CP_HW_FAULT_ADDR A:0x61c01170
y.create.l HWIO_OXILI_CP_AHB_FAULT_ADDR A:0x61c01174
y.create.l HWIO_OXILI_CP_PROTECT_CTRL_ADDR A:0x61c01178
y.create.l HWIO_OXILI_CP_PROTECT_STATUS_ADDR A:0x61c0117c
y.create.l HWIO_OXILI_CP_PROTECT_REG_0_ADDR A:0x61c01180
y.create.l HWIO_OXILI_CP_PROTECT_REG_1_ADDR A:0x61c01184
y.create.l HWIO_OXILI_CP_PROTECT_REG_2_ADDR A:0x61c01188
y.create.l HWIO_OXILI_CP_PROTECT_REG_3_ADDR A:0x61c0118c
y.create.l HWIO_OXILI_CP_PROTECT_REG_4_ADDR A:0x61c01190
y.create.l HWIO_OXILI_CP_PROTECT_REG_5_ADDR A:0x61c01194
y.create.l HWIO_OXILI_CP_PROTECT_REG_6_ADDR A:0x61c01198
y.create.l HWIO_OXILI_CP_PROTECT_REG_7_ADDR A:0x61c0119c
y.create.l HWIO_OXILI_CP_PROTECT_REG_8_ADDR A:0x61c011a0
y.create.l HWIO_OXILI_CP_PROTECT_REG_9_ADDR A:0x61c011a4
y.create.l HWIO_OXILI_CP_PROTECT_REG_A_ADDR A:0x61c011a8
y.create.l HWIO_OXILI_CP_PROTECT_REG_B_ADDR A:0x61c011ac
y.create.l HWIO_OXILI_CP_PROTECT_REG_C_ADDR A:0x61c011b0
y.create.l HWIO_OXILI_CP_PROTECT_REG_D_ADDR A:0x61c011b4
y.create.l HWIO_OXILI_CP_PROTECT_REG_E_ADDR A:0x61c011b8
y.create.l HWIO_OXILI_CP_PROTECT_REG_F_ADDR A:0x61c011bc
y.create.l HWIO_OXILI_CP_SCRATCH_UMASK_ADDR A:0x61c00770
y.create.l HWIO_OXILI_CP_SCRATCH_ADDR_ADDR A:0x61c00774
y.create.l HWIO_OXILI_CP_SCRATCH_REG0_ADDR A:0x61c015e0
y.create.l HWIO_OXILI_CP_SCRATCH_REG1_ADDR A:0x61c015e4
y.create.l HWIO_OXILI_CP_SCRATCH_REG2_ADDR A:0x61c015e8
y.create.l HWIO_OXILI_CP_SCRATCH_REG3_ADDR A:0x61c015ec
y.create.l HWIO_OXILI_CP_SCRATCH_REG4_ADDR A:0x61c015f0
y.create.l HWIO_OXILI_CP_SCRATCH_REG5_ADDR A:0x61c015f4
y.create.l HWIO_OXILI_CP_SCRATCH_REG6_ADDR A:0x61c015f8
y.create.l HWIO_OXILI_CP_SCRATCH_REG7_ADDR A:0x61c015fc
y.create.l HWIO_OXILI_PC_BINNING_ENABLE_ADDR A:0x61c030f0
y.create.l HWIO_OXILI_PC_PC_DRAWCALL_VIZ_CONTROL_ADDR A:0x61c030f4
y.create.l HWIO_OXILI_PC_PC_DEBUG_PRIM_STEP_CONTROL_ADDR A:0x61c030f8
y.create.l HWIO_OXILI_PC_PC_DEBUG_REG_ADDR A:0x61c030fc
y.create.l HWIO_OXILI_PC_PERFCOUNTER0_SELECT_ADDR A:0x61c03120
y.create.l HWIO_OXILI_PC_PERFCOUNTER1_SELECT_ADDR A:0x61c03124
y.create.l HWIO_OXILI_PC_PERFCOUNTER2_SELECT_ADDR A:0x61c03128
y.create.l HWIO_OXILI_PC_PERFCOUNTER3_SELECT_ADDR A:0x61c0312c
y.create.l HWIO_OXILI_PC_BIN_BASE_CTX_0_ADDR A:0x61c08784
y.create.l HWIO_OXILI_PC_BIN_SIZE_CTX_0_ADDR A:0x61c08788
y.create.l HWIO_OXILI_PC_DMA_BASE_CTX_0_ADDR A:0x61c087e8
y.create.l HWIO_OXILI_PC_DMA_SIZE_CTX_0_ADDR A:0x61c087ec
y.create.l HWIO_OXILI_PC_DRAW_INITIATOR_CTX_0_ADDR A:0x61c087f0
y.create.l HWIO_OXILI_PC_VSTREAM_CONTROL_CTX_0_ADDR A:0x61c08790
y.create.l HWIO_OXILI_PC_EVENT_INITIATOR_CTX_0_ADDR A:0x61c087e4
y.create.l HWIO_OXILI_PC_IMMED_DATA_CTX_0_ADDR A:0x61c087f4
y.create.l HWIO_OXILI_PC_PRE_DRAW_INITIATOR_CTX_0_ADDR A:0x61c087f8
y.create.l HWIO_OXILI_PC_PRE_DRAW_INITIATOR_SIZE_CTX_0_ADDR A:0x61c087fc
y.create.l HWIO_OXILI_PC_VERTEX_REUSE_BLOCK_CNTL_CTX_0_ADDR A:0x61c087a8
y.create.l HWIO_OXILI_PC_PRIM_VTX_CNTL_CTX_0_ADDR A:0x61c087b0
y.create.l HWIO_OXILI_PC_RESTART_INDEX_CTX_0_ADDR A:0x61c087b4
y.create.l HWIO_OXILI_PC_CL_EXE_INITIATOR_CTX_0_ADDR A:0x61c087c0
y.create.l HWIO_OXILI_PC_BIN_BASE_CTX_1_ADDR A:0x61c09784
y.create.l HWIO_OXILI_PC_BIN_SIZE_CTX_1_ADDR A:0x61c09788
y.create.l HWIO_OXILI_PC_DMA_BASE_CTX_1_ADDR A:0x61c097e8
y.create.l HWIO_OXILI_PC_DMA_SIZE_CTX_1_ADDR A:0x61c097ec
y.create.l HWIO_OXILI_PC_DRAW_INITIATOR_CTX_1_ADDR A:0x61c097f0
y.create.l HWIO_OXILI_PC_VSTREAM_CONTROL_CTX_1_ADDR A:0x61c09790
y.create.l HWIO_OXILI_PC_EVENT_INITIATOR_CTX_1_ADDR A:0x61c097e4
y.create.l HWIO_OXILI_PC_IMMED_DATA_CTX_1_ADDR A:0x61c097f4
y.create.l HWIO_OXILI_PC_PRE_DRAW_INITIATOR_CTX_1_ADDR A:0x61c097f8
y.create.l HWIO_OXILI_PC_PRE_DRAW_INITIATOR_SIZE_CTX_1_ADDR A:0x61c097fc
y.create.l HWIO_OXILI_PC_VERTEX_REUSE_BLOCK_CNTL_CTX_1_ADDR A:0x61c097a8
y.create.l HWIO_OXILI_PC_PRIM_VTX_CNTL_CTX_1_ADDR A:0x61c097b0
y.create.l HWIO_OXILI_PC_RESTART_INDEX_CTX_1_ADDR A:0x61c097b4
y.create.l HWIO_OXILI_PC_CL_EXE_INITIATOR_CTX_1_ADDR A:0x61c097c0
y.create.l HWIO_OXILI_GRAS_CL_USER_PLANE_X0_ADDR A:0x61c03280
y.create.l HWIO_OXILI_GRAS_CL_USER_PLANE_Y0_ADDR A:0x61c03284
y.create.l HWIO_OXILI_GRAS_CL_USER_PLANE_Z0_ADDR A:0x61c03288
y.create.l HWIO_OXILI_GRAS_CL_USER_PLANE_W0_ADDR A:0x61c0328c
y.create.l HWIO_OXILI_GRAS_CL_USER_PLANE_X1_ADDR A:0x61c03290
y.create.l HWIO_OXILI_GRAS_CL_USER_PLANE_Y1_ADDR A:0x61c03294
y.create.l HWIO_OXILI_GRAS_CL_USER_PLANE_Z1_ADDR A:0x61c03298
y.create.l HWIO_OXILI_GRAS_CL_USER_PLANE_W1_ADDR A:0x61c0329c
y.create.l HWIO_OXILI_GRAS_CL_USER_PLANE_X2_ADDR A:0x61c032a0
y.create.l HWIO_OXILI_GRAS_CL_USER_PLANE_Y2_ADDR A:0x61c032a4
y.create.l HWIO_OXILI_GRAS_CL_USER_PLANE_Z2_ADDR A:0x61c032a8
y.create.l HWIO_OXILI_GRAS_CL_USER_PLANE_W2_ADDR A:0x61c032ac
y.create.l HWIO_OXILI_GRAS_CL_USER_PLANE_X3_ADDR A:0x61c032b0
y.create.l HWIO_OXILI_GRAS_CL_USER_PLANE_Y3_ADDR A:0x61c032b4
y.create.l HWIO_OXILI_GRAS_CL_USER_PLANE_Z3_ADDR A:0x61c032b8
y.create.l HWIO_OXILI_GRAS_CL_USER_PLANE_W3_ADDR A:0x61c032bc
y.create.l HWIO_OXILI_GRAS_CL_USER_PLANE_X4_ADDR A:0x61c032c0
y.create.l HWIO_OXILI_GRAS_CL_USER_PLANE_Y4_ADDR A:0x61c032c4
y.create.l HWIO_OXILI_GRAS_CL_USER_PLANE_Z4_ADDR A:0x61c032c8
y.create.l HWIO_OXILI_GRAS_CL_USER_PLANE_W4_ADDR A:0x61c032cc
y.create.l HWIO_OXILI_GRAS_CL_USER_PLANE_X5_ADDR A:0x61c032d0
y.create.l HWIO_OXILI_GRAS_CL_USER_PLANE_Y5_ADDR A:0x61c032d4
y.create.l HWIO_OXILI_GRAS_CL_USER_PLANE_Z5_ADDR A:0x61c032d8
y.create.l HWIO_OXILI_GRAS_CL_USER_PLANE_W5_ADDR A:0x61c032dc
y.create.l HWIO_OXILI_GRAS_TSE_STATUS_ADDR A:0x61c03200
y.create.l HWIO_OXILI_GRAS_TSE_DEBUG_ECO_ADDR A:0x61c03204
y.create.l HWIO_OXILI_GRAS_SU_PERFCOUNTER0_SELECT_ADDR A:0x61c03220
y.create.l HWIO_OXILI_GRAS_SU_PERFCOUNTER1_SELECT_ADDR A:0x61c03224
y.create.l HWIO_OXILI_GRAS_SU_PERFCOUNTER2_SELECT_ADDR A:0x61c03228
y.create.l HWIO_OXILI_GRAS_SU_PERFCOUNTER3_SELECT_ADDR A:0x61c0322c
y.create.l HWIO_OXILI_GRAS_CL_CLIP_CNTL_CTX_0_ADDR A:0x61c08100
y.create.l HWIO_OXILI_GRAS_CL_GB_CLIP_ADJ_CTX_0_ADDR A:0x61c08110
y.create.l HWIO_OXILI_GRAS_CL_VPORT_XOFFSET_CTX_0_ADDR A:0x61c08120
y.create.l HWIO_OXILI_GRAS_CL_VPORT_XSCALE_CTX_0_ADDR A:0x61c08124
y.create.l HWIO_OXILI_GRAS_CL_VPORT_YOFFSET_CTX_0_ADDR A:0x61c08128
y.create.l HWIO_OXILI_GRAS_CL_VPORT_YSCALE_CTX_0_ADDR A:0x61c0812c
y.create.l HWIO_OXILI_GRAS_CL_VPORT_ZOFFSET_CTX_0_ADDR A:0x61c08130
y.create.l HWIO_OXILI_GRAS_CL_VPORT_ZSCALE_CTX_0_ADDR A:0x61c08134
y.create.l HWIO_OXILI_GRAS_SU_POINT_MINMAX_CTX_0_ADDR A:0x61c081a0
y.create.l HWIO_OXILI_GRAS_SU_POINT_SIZE_CTX_0_ADDR A:0x61c081a4
y.create.l HWIO_OXILI_GRAS_SU_POLY_OFFSET_OFFSET_CTX_0_ADDR A:0x61c081b4
y.create.l HWIO_OXILI_GRAS_SU_POLY_OFFSET_SCALE_CTX_0_ADDR A:0x61c081b0
y.create.l HWIO_OXILI_GRAS_SU_MODE_CONTROL_CTX_0_ADDR A:0x61c081c0
y.create.l HWIO_OXILI_GRAS_SC_CONTROL_CTX_0_ADDR A:0x61c081c8
y.create.l HWIO_OXILI_GRAS_SC_SCREEN_SCISSOR_TL_CTX_0_ADDR A:0x61c081d0
y.create.l HWIO_OXILI_GRAS_SC_SCREEN_SCISSOR_BR_CTX_0_ADDR A:0x61c081d4
y.create.l HWIO_OXILI_GRAS_SC_WINDOW_SCISSOR_BR_CTX_0_ADDR A:0x61c081e8
y.create.l HWIO_OXILI_GRAS_SC_WINDOW_SCISSOR_TL_CTX_0_ADDR A:0x61c081e4
y.create.l HWIO_OXILI_GRAS_CL_CLIP_CNTL_CTX_1_ADDR A:0x61c09100
y.create.l HWIO_OXILI_GRAS_CL_GB_CLIP_ADJ_CTX_1_ADDR A:0x61c09110
y.create.l HWIO_OXILI_GRAS_CL_VPORT_XOFFSET_CTX_1_ADDR A:0x61c09120
y.create.l HWIO_OXILI_GRAS_CL_VPORT_XSCALE_CTX_1_ADDR A:0x61c09124
y.create.l HWIO_OXILI_GRAS_CL_VPORT_YOFFSET_CTX_1_ADDR A:0x61c09128
y.create.l HWIO_OXILI_GRAS_CL_VPORT_YSCALE_CTX_1_ADDR A:0x61c0912c
y.create.l HWIO_OXILI_GRAS_CL_VPORT_ZOFFSET_CTX_1_ADDR A:0x61c09130
y.create.l HWIO_OXILI_GRAS_CL_VPORT_ZSCALE_CTX_1_ADDR A:0x61c09134
y.create.l HWIO_OXILI_GRAS_SU_POINT_MINMAX_CTX_1_ADDR A:0x61c091a0
y.create.l HWIO_OXILI_GRAS_SU_POINT_SIZE_CTX_1_ADDR A:0x61c091a4
y.create.l HWIO_OXILI_GRAS_SU_POLY_OFFSET_OFFSET_CTX_1_ADDR A:0x61c091b4
y.create.l HWIO_OXILI_GRAS_SU_POLY_OFFSET_SCALE_CTX_1_ADDR A:0x61c091b0
y.create.l HWIO_OXILI_GRAS_SU_MODE_CONTROL_CTX_1_ADDR A:0x61c091c0
y.create.l HWIO_OXILI_GRAS_SC_CONTROL_CTX_1_ADDR A:0x61c091c8
y.create.l HWIO_OXILI_GRAS_SC_SCREEN_SCISSOR_TL_CTX_1_ADDR A:0x61c091d0
y.create.l HWIO_OXILI_GRAS_SC_SCREEN_SCISSOR_BR_CTX_1_ADDR A:0x61c091d4
y.create.l HWIO_OXILI_GRAS_SC_WINDOW_SCISSOR_BR_CTX_1_ADDR A:0x61c091e8
y.create.l HWIO_OXILI_GRAS_SC_WINDOW_SCISSOR_TL_CTX_1_ADDR A:0x61c091e4
y.create.l HWIO_OXILI_HLSQ_PERFCOUNTER0_SELECT_REG_ADDR A:0x61c03800
y.create.l HWIO_OXILI_HLSQ_PERFCOUNTER1_SELECT_REG_ADDR A:0x61c03804
y.create.l HWIO_OXILI_HLSQ_PERFCOUNTER2_SELECT_REG_ADDR A:0x61c03808
y.create.l HWIO_OXILI_HLSQ_PERFCOUNTER3_SELECT_REG_ADDR A:0x61c0380c
y.create.l HWIO_OXILI_HLSQ_PERFCOUNTER4_SELECT_REG_ADDR A:0x61c03810
y.create.l HWIO_OXILI_HLSQ_PERFCOUNTER5_SELECT_REG_ADDR A:0x61c03814
y.create.l HWIO_OXILI_HLSQ_GLOBAL_MEM_LENGTH_REG_ADDR A:0x61c03888
y.create.l HWIO_OXILI_HLSQ_GLOBAL_MEM_ADDRESS_REG_ADDR A:0x61c0388c
y.create.l HWIO_OXILI_HLSQ_HLSQ_TIMEOUT_THRESHOLD_ADDR A:0x61c03830
y.create.l HWIO_OXILI_HLSQ_HLSQ_STAR_RDSEL_ADDR A:0x61c03884
y.create.l HWIO_OXILI_HLSQ_CONTROL_0_REG_CTX_0_ADDR A:0x61c08800
y.create.l HWIO_OXILI_HLSQ_CONTROL_1_REG_CTX_0_ADDR A:0x61c08804
y.create.l HWIO_OXILI_HLSQ_CONTROL_2_REG_CTX_0_ADDR A:0x61c08808
y.create.l HWIO_OXILI_HLSQ_CONTROL_3_REG_CTX_0_ADDR A:0x61c0880c
y.create.l HWIO_OXILI_HLSQ_VS_CONTROL_REG_CTX_0_ADDR A:0x61c08810
y.create.l HWIO_OXILI_HLSQ_FS_CONTROL_REG_CTX_0_ADDR A:0x61c08814
y.create.l HWIO_OXILI_HLSQ_CONST_VSPRESV_RANGE_REG_CTX_0_ADDR A:0x61c08818
y.create.l HWIO_OXILI_HLSQ_CONST_FSPRESV_RANGE_REG_CTX_0_ADDR A:0x61c0881c
y.create.l HWIO_OXILI_HLSQ_LOAD_CMD_0_REG_CTX_0_ADDR A:0x61c08820
y.create.l HWIO_OXILI_HLSQ_LOAD_CMD_1_REG_CTX_0_ADDR A:0x61c08824
y.create.l HWIO_OXILI_HLSQ_CL_NDRANGE_0_REG_CTX_0_ADDR A:0x61c08828
y.create.l HWIO_OXILI_HLSQ_CL_NDRANGE_1_REG_CTX_0_ADDR A:0x61c0882c
y.create.l HWIO_OXILI_HLSQ_CL_NDRANGE_2_REG_CTX_0_ADDR A:0x61c08830
y.create.l HWIO_OXILI_HLSQ_CL_NDRANGE_3_REG_CTX_0_ADDR A:0x61c08834
y.create.l HWIO_OXILI_HLSQ_CL_NDRANGE_4_REG_CTX_0_ADDR A:0x61c08838
y.create.l HWIO_OXILI_HLSQ_CL_NDRANGE_5_REG_CTX_0_ADDR A:0x61c0883c
y.create.l HWIO_OXILI_HLSQ_CL_NDRANGE_6_REG_CTX_0_ADDR A:0x61c08840
y.create.l HWIO_OXILI_HLSQ_CL_CONTROL_0_REG_CTX_0_ADDR A:0x61c08844
y.create.l HWIO_OXILI_HLSQ_CL_CONTROL_1_REG_CTX_0_ADDR A:0x61c08848
y.create.l HWIO_OXILI_HLSQ_CL_KERNEL_CONST_REG_CTX_0_ADDR A:0x61c08850
y.create.l HWIO_OXILI_HLSQ_CL_KERNEL_GROUP_X_REG_CTX_0_ADDR A:0x61c08854
y.create.l HWIO_OXILI_HLSQ_CL_KERNEL_GROUP_Y_REG_CTX_0_ADDR A:0x61c08858
y.create.l HWIO_OXILI_HLSQ_CL_KERNEL_GROUP_Z_REG_CTX_0_ADDR A:0x61c0885c
y.create.l HWIO_OXILI_HLSQ_CL_WG_OFFSET_REG_CTX_0_ADDR A:0x61c08868
y.create.l HWIO_OXILI_HLSQ_CONTROL_0_REG_CTX_1_ADDR A:0x61c09800
y.create.l HWIO_OXILI_HLSQ_CONTROL_1_REG_CTX_1_ADDR A:0x61c09804
y.create.l HWIO_OXILI_HLSQ_CONTROL_2_REG_CTX_1_ADDR A:0x61c09808
y.create.l HWIO_OXILI_HLSQ_CONTROL_3_REG_CTX_1_ADDR A:0x61c0980c
y.create.l HWIO_OXILI_HLSQ_VS_CONTROL_REG_CTX_1_ADDR A:0x61c09810
y.create.l HWIO_OXILI_HLSQ_FS_CONTROL_REG_CTX_1_ADDR A:0x61c09814
y.create.l HWIO_OXILI_HLSQ_CONST_VSPRESV_RANGE_REG_CTX_1_ADDR A:0x61c09818
y.create.l HWIO_OXILI_HLSQ_CONST_FSPRESV_RANGE_REG_CTX_1_ADDR A:0x61c0981c
y.create.l HWIO_OXILI_HLSQ_LOAD_CMD_0_REG_CTX_1_ADDR A:0x61c09820
y.create.l HWIO_OXILI_HLSQ_LOAD_CMD_1_REG_CTX_1_ADDR A:0x61c09824
y.create.l HWIO_OXILI_HLSQ_CL_NDRANGE_0_REG_CTX_1_ADDR A:0x61c09828
y.create.l HWIO_OXILI_HLSQ_CL_NDRANGE_1_REG_CTX_1_ADDR A:0x61c0982c
y.create.l HWIO_OXILI_HLSQ_CL_NDRANGE_2_REG_CTX_1_ADDR A:0x61c09830
y.create.l HWIO_OXILI_HLSQ_CL_NDRANGE_3_REG_CTX_1_ADDR A:0x61c09834
y.create.l HWIO_OXILI_HLSQ_CL_NDRANGE_4_REG_CTX_1_ADDR A:0x61c09838
y.create.l HWIO_OXILI_HLSQ_CL_NDRANGE_5_REG_CTX_1_ADDR A:0x61c0983c
y.create.l HWIO_OXILI_HLSQ_CL_NDRANGE_6_REG_CTX_1_ADDR A:0x61c09840
y.create.l HWIO_OXILI_HLSQ_CL_CONTROL_0_REG_CTX_1_ADDR A:0x61c09844
y.create.l HWIO_OXILI_HLSQ_CL_CONTROL_1_REG_CTX_1_ADDR A:0x61c09848
y.create.l HWIO_OXILI_HLSQ_CL_KERNEL_CONST_REG_CTX_1_ADDR A:0x61c09850
y.create.l HWIO_OXILI_HLSQ_CL_KERNEL_GROUP_X_REG_CTX_1_ADDR A:0x61c09854
y.create.l HWIO_OXILI_HLSQ_CL_KERNEL_GROUP_Y_REG_CTX_1_ADDR A:0x61c09858
y.create.l HWIO_OXILI_HLSQ_CL_KERNEL_GROUP_Z_REG_CTX_1_ADDR A:0x61c0985c
y.create.l HWIO_OXILI_HLSQ_CL_WG_OFFSET_REG_CTX_1_ADDR A:0x61c09868
y.create.l HWIO_OXILI_VFD_MODE_CONTROL_ADDR A:0x61c0390c
y.create.l HWIO_OXILI_VFD_STATUS_ADDR A:0x61c03908
y.create.l HWIO_OXILI_VFD_VFD_DEBUG_CONTROL_ADDR A:0x61c03904
y.create.l HWIO_OXILI_VFD_PERFCOUNTER0_SELECT_ADDR A:0x61c03910
y.create.l HWIO_OXILI_VFD_PERFCOUNTER1_SELECT_ADDR A:0x61c03914
y.create.l HWIO_OXILI_VFD_CONTROL_0_CTX_0_ADDR A:0x61c08900
y.create.l HWIO_OXILI_VFD_CONTROL_1_CTX_0_ADDR A:0x61c08904
y.create.l HWIO_OXILI_VFD_INDEX_MIN_CTX_0_ADDR A:0x61c08908
y.create.l HWIO_OXILI_VFD_INDEX_MAX_CTX_0_ADDR A:0x61c0890c
y.create.l HWIO_OXILI_VFD_INSTANCEID_OFFSET_CTX_0_ADDR A:0x61c08910
y.create.l HWIO_OXILI_VFD_INDEX_OFFSET_CTX_0_ADDR A:0x61c08914
y.create.l HWIO_OXILI_VFD_FETCH_INSTR_0_0_CTX_0_ADDR A:0x61c08918
y.create.l HWIO_OXILI_VFD_FETCH_INSTR_1_0_CTX_0_ADDR A:0x61c0891c
y.create.l HWIO_OXILI_VFD_FETCH_INSTR_0_1_CTX_0_ADDR A:0x61c08920
y.create.l HWIO_OXILI_VFD_FETCH_INSTR_1_1_CTX_0_ADDR A:0x61c08924
y.create.l HWIO_OXILI_VFD_FETCH_INSTR_0_2_CTX_0_ADDR A:0x61c08928
y.create.l HWIO_OXILI_VFD_FETCH_INSTR_1_2_CTX_0_ADDR A:0x61c0892c
y.create.l HWIO_OXILI_VFD_FETCH_INSTR_0_3_CTX_0_ADDR A:0x61c08930
y.create.l HWIO_OXILI_VFD_FETCH_INSTR_1_3_CTX_0_ADDR A:0x61c08934
y.create.l HWIO_OXILI_VFD_FETCH_INSTR_0_4_CTX_0_ADDR A:0x61c08938
y.create.l HWIO_OXILI_VFD_FETCH_INSTR_1_4_CTX_0_ADDR A:0x61c0893c
y.create.l HWIO_OXILI_VFD_FETCH_INSTR_0_5_CTX_0_ADDR A:0x61c08940
y.create.l HWIO_OXILI_VFD_FETCH_INSTR_1_5_CTX_0_ADDR A:0x61c08944
y.create.l HWIO_OXILI_VFD_FETCH_INSTR_0_6_CTX_0_ADDR A:0x61c08948
y.create.l HWIO_OXILI_VFD_FETCH_INSTR_1_6_CTX_0_ADDR A:0x61c0894c
y.create.l HWIO_OXILI_VFD_FETCH_INSTR_0_7_CTX_0_ADDR A:0x61c08950
y.create.l HWIO_OXILI_VFD_FETCH_INSTR_1_7_CTX_0_ADDR A:0x61c08954
y.create.l HWIO_OXILI_VFD_FETCH_INSTR_0_8_CTX_0_ADDR A:0x61c08958
y.create.l HWIO_OXILI_VFD_FETCH_INSTR_1_8_CTX_0_ADDR A:0x61c0895c
y.create.l HWIO_OXILI_VFD_FETCH_INSTR_0_9_CTX_0_ADDR A:0x61c08960
y.create.l HWIO_OXILI_VFD_FETCH_INSTR_1_9_CTX_0_ADDR A:0x61c08964
y.create.l HWIO_OXILI_VFD_FETCH_INSTR_0_A_CTX_0_ADDR A:0x61c08968
y.create.l HWIO_OXILI_VFD_FETCH_INSTR_1_A_CTX_0_ADDR A:0x61c0896c
y.create.l HWIO_OXILI_VFD_FETCH_INSTR_0_B_CTX_0_ADDR A:0x61c08970
y.create.l HWIO_OXILI_VFD_FETCH_INSTR_1_B_CTX_0_ADDR A:0x61c08974
y.create.l HWIO_OXILI_VFD_FETCH_INSTR_0_C_CTX_0_ADDR A:0x61c08978
y.create.l HWIO_OXILI_VFD_FETCH_INSTR_1_C_CTX_0_ADDR A:0x61c0897c
y.create.l HWIO_OXILI_VFD_FETCH_INSTR_0_D_CTX_0_ADDR A:0x61c08980
y.create.l HWIO_OXILI_VFD_FETCH_INSTR_1_D_CTX_0_ADDR A:0x61c08984
y.create.l HWIO_OXILI_VFD_FETCH_INSTR_0_E_CTX_0_ADDR A:0x61c08988
y.create.l HWIO_OXILI_VFD_FETCH_INSTR_1_E_CTX_0_ADDR A:0x61c0898c
y.create.l HWIO_OXILI_VFD_FETCH_INSTR_0_F_CTX_0_ADDR A:0x61c08990
y.create.l HWIO_OXILI_VFD_FETCH_INSTR_1_F_CTX_0_ADDR A:0x61c08994
y.create.l HWIO_OXILI_VFD_DECODE_INSTR_0_CTX_0_ADDR A:0x61c08998
y.create.l HWIO_OXILI_VFD_DECODE_INSTR_1_CTX_0_ADDR A:0x61c0899c
y.create.l HWIO_OXILI_VFD_DECODE_INSTR_2_CTX_0_ADDR A:0x61c089a0
y.create.l HWIO_OXILI_VFD_DECODE_INSTR_3_CTX_0_ADDR A:0x61c089a4
y.create.l HWIO_OXILI_VFD_DECODE_INSTR_4_CTX_0_ADDR A:0x61c089a8
y.create.l HWIO_OXILI_VFD_DECODE_INSTR_5_CTX_0_ADDR A:0x61c089ac
y.create.l HWIO_OXILI_VFD_DECODE_INSTR_6_CTX_0_ADDR A:0x61c089b0
y.create.l HWIO_OXILI_VFD_DECODE_INSTR_7_CTX_0_ADDR A:0x61c089b4
y.create.l HWIO_OXILI_VFD_DECODE_INSTR_8_CTX_0_ADDR A:0x61c089b8
y.create.l HWIO_OXILI_VFD_DECODE_INSTR_9_CTX_0_ADDR A:0x61c089bc
y.create.l HWIO_OXILI_VFD_DECODE_INSTR_10_CTX_0_ADDR A:0x61c089c0
y.create.l HWIO_OXILI_VFD_DECODE_INSTR_11_CTX_0_ADDR A:0x61c089c4
y.create.l HWIO_OXILI_VFD_DECODE_INSTR_12_CTX_0_ADDR A:0x61c089c8
y.create.l HWIO_OXILI_VFD_DECODE_INSTR_13_CTX_0_ADDR A:0x61c089cc
y.create.l HWIO_OXILI_VFD_DECODE_INSTR_14_CTX_0_ADDR A:0x61c089d0
y.create.l HWIO_OXILI_VFD_DECODE_INSTR_15_CTX_0_ADDR A:0x61c089d4
y.create.l HWIO_OXILI_VFD_DECODE_INSTR_16_CTX_0_ADDR A:0x61c089d8
y.create.l HWIO_OXILI_VFD_DECODE_INSTR_17_CTX_0_ADDR A:0x61c089dc
y.create.l HWIO_OXILI_VFD_DECODE_INSTR_18_CTX_0_ADDR A:0x61c089e0
y.create.l HWIO_OXILI_VFD_DECODE_INSTR_19_CTX_0_ADDR A:0x61c089e4
y.create.l HWIO_OXILI_VFD_DECODE_INSTR_20_CTX_0_ADDR A:0x61c089e8
y.create.l HWIO_OXILI_VFD_DECODE_INSTR_21_CTX_0_ADDR A:0x61c089ec
y.create.l HWIO_OXILI_VFD_DECODE_INSTR_22_CTX_0_ADDR A:0x61c089f0
y.create.l HWIO_OXILI_VFD_DECODE_INSTR_23_CTX_0_ADDR A:0x61c089f4
y.create.l HWIO_OXILI_VFD_VS_THREADING_THRESHOLD_CTX_0_ADDR A:0x61c089f8
y.create.l HWIO_OXILI_VFD_CONTROL_0_CTX_1_ADDR A:0x61c09900
y.create.l HWIO_OXILI_VFD_CONTROL_1_CTX_1_ADDR A:0x61c09904
y.create.l HWIO_OXILI_VFD_INDEX_MIN_CTX_1_ADDR A:0x61c09908
y.create.l HWIO_OXILI_VFD_INDEX_MAX_CTX_1_ADDR A:0x61c0990c
y.create.l HWIO_OXILI_VFD_INSTANCEID_OFFSET_CTX_1_ADDR A:0x61c09910
y.create.l HWIO_OXILI_VFD_INDEX_OFFSET_CTX_1_ADDR A:0x61c09914
y.create.l HWIO_OXILI_VFD_FETCH_INSTR_0_0_CTX_1_ADDR A:0x61c09918
y.create.l HWIO_OXILI_VFD_FETCH_INSTR_1_0_CTX_1_ADDR A:0x61c0991c
y.create.l HWIO_OXILI_VFD_FETCH_INSTR_0_1_CTX_1_ADDR A:0x61c09920
y.create.l HWIO_OXILI_VFD_FETCH_INSTR_1_1_CTX_1_ADDR A:0x61c09924
y.create.l HWIO_OXILI_VFD_FETCH_INSTR_0_2_CTX_1_ADDR A:0x61c09928
y.create.l HWIO_OXILI_VFD_FETCH_INSTR_1_2_CTX_1_ADDR A:0x61c0992c
y.create.l HWIO_OXILI_VFD_FETCH_INSTR_0_3_CTX_1_ADDR A:0x61c09930
y.create.l HWIO_OXILI_VFD_FETCH_INSTR_1_3_CTX_1_ADDR A:0x61c09934
y.create.l HWIO_OXILI_VFD_FETCH_INSTR_0_4_CTX_1_ADDR A:0x61c09938
y.create.l HWIO_OXILI_VFD_FETCH_INSTR_1_4_CTX_1_ADDR A:0x61c0993c
y.create.l HWIO_OXILI_VFD_FETCH_INSTR_0_5_CTX_1_ADDR A:0x61c09940
y.create.l HWIO_OXILI_VFD_FETCH_INSTR_1_5_CTX_1_ADDR A:0x61c09944
y.create.l HWIO_OXILI_VFD_FETCH_INSTR_0_6_CTX_1_ADDR A:0x61c09948
y.create.l HWIO_OXILI_VFD_FETCH_INSTR_1_6_CTX_1_ADDR A:0x61c0994c
y.create.l HWIO_OXILI_VFD_FETCH_INSTR_0_7_CTX_1_ADDR A:0x61c09950
y.create.l HWIO_OXILI_VFD_FETCH_INSTR_1_7_CTX_1_ADDR A:0x61c09954
y.create.l HWIO_OXILI_VFD_FETCH_INSTR_0_8_CTX_1_ADDR A:0x61c09958
y.create.l HWIO_OXILI_VFD_FETCH_INSTR_1_8_CTX_1_ADDR A:0x61c0995c
y.create.l HWIO_OXILI_VFD_FETCH_INSTR_0_9_CTX_1_ADDR A:0x61c09960
y.create.l HWIO_OXILI_VFD_FETCH_INSTR_1_9_CTX_1_ADDR A:0x61c09964
y.create.l HWIO_OXILI_VFD_FETCH_INSTR_0_A_CTX_1_ADDR A:0x61c09968
y.create.l HWIO_OXILI_VFD_FETCH_INSTR_1_A_CTX_1_ADDR A:0x61c0996c
y.create.l HWIO_OXILI_VFD_FETCH_INSTR_0_B_CTX_1_ADDR A:0x61c09970
y.create.l HWIO_OXILI_VFD_FETCH_INSTR_1_B_CTX_1_ADDR A:0x61c09974
y.create.l HWIO_OXILI_VFD_FETCH_INSTR_0_C_CTX_1_ADDR A:0x61c09978
y.create.l HWIO_OXILI_VFD_FETCH_INSTR_1_C_CTX_1_ADDR A:0x61c0997c
y.create.l HWIO_OXILI_VFD_FETCH_INSTR_0_D_CTX_1_ADDR A:0x61c09980
y.create.l HWIO_OXILI_VFD_FETCH_INSTR_1_D_CTX_1_ADDR A:0x61c09984
y.create.l HWIO_OXILI_VFD_FETCH_INSTR_0_E_CTX_1_ADDR A:0x61c09988
y.create.l HWIO_OXILI_VFD_FETCH_INSTR_1_E_CTX_1_ADDR A:0x61c0998c
y.create.l HWIO_OXILI_VFD_FETCH_INSTR_0_F_CTX_1_ADDR A:0x61c09990
y.create.l HWIO_OXILI_VFD_FETCH_INSTR_1_F_CTX_1_ADDR A:0x61c09994
y.create.l HWIO_OXILI_VFD_DECODE_INSTR_0_CTX_1_ADDR A:0x61c09998
y.create.l HWIO_OXILI_VFD_DECODE_INSTR_1_CTX_1_ADDR A:0x61c0999c
y.create.l HWIO_OXILI_VFD_DECODE_INSTR_2_CTX_1_ADDR A:0x61c099a0
y.create.l HWIO_OXILI_VFD_DECODE_INSTR_3_CTX_1_ADDR A:0x61c099a4
y.create.l HWIO_OXILI_VFD_DECODE_INSTR_4_CTX_1_ADDR A:0x61c099a8
y.create.l HWIO_OXILI_VFD_DECODE_INSTR_5_CTX_1_ADDR A:0x61c099ac
y.create.l HWIO_OXILI_VFD_DECODE_INSTR_6_CTX_1_ADDR A:0x61c099b0
y.create.l HWIO_OXILI_VFD_DECODE_INSTR_7_CTX_1_ADDR A:0x61c099b4
y.create.l HWIO_OXILI_VFD_DECODE_INSTR_8_CTX_1_ADDR A:0x61c099b8
y.create.l HWIO_OXILI_VFD_DECODE_INSTR_9_CTX_1_ADDR A:0x61c099bc
y.create.l HWIO_OXILI_VFD_DECODE_INSTR_10_CTX_1_ADDR A:0x61c099c0
y.create.l HWIO_OXILI_VFD_DECODE_INSTR_11_CTX_1_ADDR A:0x61c099c4
y.create.l HWIO_OXILI_VFD_DECODE_INSTR_12_CTX_1_ADDR A:0x61c099c8
y.create.l HWIO_OXILI_VFD_DECODE_INSTR_13_CTX_1_ADDR A:0x61c099cc
y.create.l HWIO_OXILI_VFD_DECODE_INSTR_14_CTX_1_ADDR A:0x61c099d0
y.create.l HWIO_OXILI_VFD_DECODE_INSTR_15_CTX_1_ADDR A:0x61c099d4
y.create.l HWIO_OXILI_VFD_DECODE_INSTR_16_CTX_1_ADDR A:0x61c099d8
y.create.l HWIO_OXILI_VFD_DECODE_INSTR_17_CTX_1_ADDR A:0x61c099dc
y.create.l HWIO_OXILI_VFD_DECODE_INSTR_18_CTX_1_ADDR A:0x61c099e0
y.create.l HWIO_OXILI_VFD_DECODE_INSTR_19_CTX_1_ADDR A:0x61c099e4
y.create.l HWIO_OXILI_VFD_DECODE_INSTR_20_CTX_1_ADDR A:0x61c099e8
y.create.l HWIO_OXILI_VFD_DECODE_INSTR_21_CTX_1_ADDR A:0x61c099ec
y.create.l HWIO_OXILI_VFD_DECODE_INSTR_22_CTX_1_ADDR A:0x61c099f0
y.create.l HWIO_OXILI_VFD_DECODE_INSTR_23_CTX_1_ADDR A:0x61c099f4
y.create.l HWIO_OXILI_VFD_VS_THREADING_THRESHOLD_CTX_1_ADDR A:0x61c099f8
y.create.l HWIO_OXILI_VPC_VPC_DEBUG_RAM_SEL_ADDR A:0x61c03984
y.create.l HWIO_OXILI_VPC_VPC_DEBUG_RAM_READ_ADDR A:0x61c03988
y.create.l HWIO_OXILI_VPC_VPC_DEBUG_ADDR A:0x61c0398c
y.create.l HWIO_OXILI_VPC_PERFCOUNTER0_SELECT_ADDR A:0x61c03990
y.create.l HWIO_OXILI_VPC_PERFCOUNTER1_SELECT_ADDR A:0x61c03994
y.create.l HWIO_OXILI_VPC_ATTR_CTX_0_ADDR A:0x61c08a00
y.create.l HWIO_OXILI_VPC_PACK_CTX_0_ADDR A:0x61c08a04
y.create.l HWIO_OXILI_VPC_VARYING_INTERP_MODE_0_CTX_0_ADDR A:0x61c08a08
y.create.l HWIO_OXILI_VPC_VARYING_INTERP_MODE_1_CTX_0_ADDR A:0x61c08a0c
y.create.l HWIO_OXILI_VPC_VARYING_INTERP_MODE_2_CTX_0_ADDR A:0x61c08a10
y.create.l HWIO_OXILI_VPC_VARYING_INTERP_MODE_3_CTX_0_ADDR A:0x61c08a14
y.create.l HWIO_OXILI_VPC_VARYING_PS_REPL_MODE_0_CTX_0_ADDR A:0x61c08a18
y.create.l HWIO_OXILI_VPC_VARYING_PS_REPL_MODE_1_CTX_0_ADDR A:0x61c08a1c
y.create.l HWIO_OXILI_VPC_VARYING_PS_REPL_MODE_2_CTX_0_ADDR A:0x61c08a20
y.create.l HWIO_OXILI_VPC_VARYING_PS_REPL_MODE_3_CTX_0_ADDR A:0x61c08a24
y.create.l HWIO_OXILI_VPC_VARY_CYLWRAP_ENABLE_0_CTX_0_ADDR A:0x61c08a28
y.create.l HWIO_OXILI_VPC_VARY_CYLWRAP_ENABLE_1_CTX_0_ADDR A:0x61c08a2c
y.create.l HWIO_OXILI_VPC_ATTR_CTX_1_ADDR A:0x61c09a00
y.create.l HWIO_OXILI_VPC_PACK_CTX_1_ADDR A:0x61c09a04
y.create.l HWIO_OXILI_VPC_VARYING_INTERP_MODE_0_CTX_1_ADDR A:0x61c09a08
y.create.l HWIO_OXILI_VPC_VARYING_INTERP_MODE_1_CTX_1_ADDR A:0x61c09a0c
y.create.l HWIO_OXILI_VPC_VARYING_INTERP_MODE_2_CTX_1_ADDR A:0x61c09a10
y.create.l HWIO_OXILI_VPC_VARYING_INTERP_MODE_3_CTX_1_ADDR A:0x61c09a14
y.create.l HWIO_OXILI_VPC_VARYING_PS_REPL_MODE_0_CTX_1_ADDR A:0x61c09a18
y.create.l HWIO_OXILI_VPC_VARYING_PS_REPL_MODE_1_CTX_1_ADDR A:0x61c09a1c
y.create.l HWIO_OXILI_VPC_VARYING_PS_REPL_MODE_2_CTX_1_ADDR A:0x61c09a20
y.create.l HWIO_OXILI_VPC_VARYING_PS_REPL_MODE_3_CTX_1_ADDR A:0x61c09a24
y.create.l HWIO_OXILI_VPC_VARY_CYLWRAP_ENABLE_0_CTX_1_ADDR A:0x61c09a28
y.create.l HWIO_OXILI_VPC_VARY_CYLWRAP_ENABLE_1_CTX_1_ADDR A:0x61c09a2c
y.create.l HWIO_OXILI_UCHE_MEM_RANGE_MIN_REG_ADDR A:0x61c03a90
y.create.l HWIO_OXILI_UCHE_MEM_RANGE_MAX_REG_ADDR A:0x61c03a94
y.create.l HWIO_OXILI_UCHE_CACHE_WAYS_VFD_REG_ADDR A:0x61c03a98
y.create.l HWIO_OXILI_UCHE_CACHE_WAYS_RB_REG_ADDR A:0x61c03a9c
y.create.l HWIO_OXILI_UCHE_CACHE_STATUS_REG_ADDR A:0x61c03a00
y.create.l HWIO_OXILI_UCHE_CACHE_DEBUG_ECO_ADDR A:0x61c03a04
y.create.l HWIO_OXILI_UCHE_CACHE_INVALIDATE0_REG_ADDR A:0x61c03a80
y.create.l HWIO_OXILI_UCHE_CACHE_INVALIDATE1_REG_ADDR A:0x61c03a84
y.create.l HWIO_OXILI_UCHE_CACHE_MODE_CONTROL_REG_ADDR A:0x61c03a08
y.create.l HWIO_OXILI_UCHE_PERFCOUNTER0_SELECT_REG_ADDR A:0x61c03a10
y.create.l HWIO_OXILI_UCHE_PERFCOUNTER1_SELECT_REG_ADDR A:0x61c03a14
y.create.l HWIO_OXILI_UCHE_PERFCOUNTER2_SELECT_REG_ADDR A:0x61c03a18
y.create.l HWIO_OXILI_UCHE_PERFCOUNTER3_SELECT_REG_ADDR A:0x61c03a1c
y.create.l HWIO_OXILI_UCHE_PERFCOUNTER4_SELECT_REG_ADDR A:0x61c03a20
y.create.l HWIO_OXILI_UCHE_PERFCOUNTER5_SELECT_REG_ADDR A:0x61c03a24
y.create.l HWIO_OXILI_SP_PERFCOUNTER0_SELECT_ADDR A:0x61c03b10
y.create.l HWIO_OXILI_SP_PERFCOUNTER1_SELECT_ADDR A:0x61c03b14
y.create.l HWIO_OXILI_SP_PERFCOUNTER2_SELECT_ADDR A:0x61c03b18
y.create.l HWIO_OXILI_SP_PERFCOUNTER3_SELECT_ADDR A:0x61c03b1c
y.create.l HWIO_OXILI_SP_PERFCOUNTER4_SELECT_ADDR A:0x61c03b20
y.create.l HWIO_OXILI_SP_PERFCOUNTER5_SELECT_ADDR A:0x61c03b24
y.create.l HWIO_OXILI_SP_PERFCOUNTER6_SELECT_ADDR A:0x61c03b28
y.create.l HWIO_OXILI_SP_PERFCOUNTER7_SELECT_ADDR A:0x61c03b2c
y.create.l HWIO_OXILI_SP_SP_MODE_CONTROL_ADDR A:0x61c03b80
y.create.l HWIO_OXILI_SP_SP_POWER_COUNTER_LOW_ADDR A:0x61c03b90
y.create.l HWIO_OXILI_SP_SP_POWER_COUNTER_HI_ADDR A:0x61c03b94
y.create.l HWIO_OXILI_SP_SP_VS_STATUS_ADDR A:0x61c03b00
y.create.l HWIO_OXILI_SP_SP_FS_STATUS_ADDR A:0x61c03b04
y.create.l HWIO_OXILI_SP_SP_DEBUG_ECO_ADDR A:0x61c03b08
y.create.l HWIO_OXILI_SP_SP_CTRL_REG_CTX_0_ADDR A:0x61c08b00
y.create.l HWIO_OXILI_SP_VS_CTRL_REG0_CTX_0_ADDR A:0x61c08b10
y.create.l HWIO_OXILI_SP_VS_CTRL_REG1_CTX_0_ADDR A:0x61c08b14
y.create.l HWIO_OXILI_SP_VS_PARAM_REG_CTX_0_ADDR A:0x61c08b18
y.create.l HWIO_OXILI_SP_VS_OUT_REG_0_CTX_0_ADDR A:0x61c08b1c
y.create.l HWIO_OXILI_SP_VS_OUT_REG_1_CTX_0_ADDR A:0x61c08b20
y.create.l HWIO_OXILI_SP_VS_OUT_REG_2_CTX_0_ADDR A:0x61c08b24
y.create.l HWIO_OXILI_SP_VS_OUT_REG_3_CTX_0_ADDR A:0x61c08b28
y.create.l HWIO_OXILI_SP_VS_OUT_REG_4_CTX_0_ADDR A:0x61c08b2c
y.create.l HWIO_OXILI_SP_VS_OUT_REG_5_CTX_0_ADDR A:0x61c08b30
y.create.l HWIO_OXILI_SP_VS_OUT_REG_6_CTX_0_ADDR A:0x61c08b34
y.create.l HWIO_OXILI_SP_VS_OUT_REG_7_CTX_0_ADDR A:0x61c08b38
y.create.l HWIO_OXILI_SP_VS_VPC_DST_REG_0_CTX_0_ADDR A:0x61c08b40
y.create.l HWIO_OXILI_SP_VS_VPC_DST_REG_1_CTX_0_ADDR A:0x61c08b44
y.create.l HWIO_OXILI_SP_VS_VPC_DST_REG_2_CTX_0_ADDR A:0x61c08b48
y.create.l HWIO_OXILI_SP_VS_VPC_DST_REG_3_CTX_0_ADDR A:0x61c08b4c
y.create.l HWIO_OXILI_SP_VS_OBJ_OFFSET_REG_CTX_0_ADDR A:0x61c08b50
y.create.l HWIO_OXILI_SP_VS_OBJ_START_REG_CTX_0_ADDR A:0x61c08b54
y.create.l HWIO_OXILI_SP_VS_PVT_MEM_PARAM_REG_CTX_0_ADDR A:0x61c08b58
y.create.l HWIO_OXILI_SP_VS_PVT_MEM_ADDR_REG_CTX_0_ADDR A:0x61c08b5c
y.create.l HWIO_OXILI_SP_VS_PVT_MEM_SIZE_REG_CTX_0_ADDR A:0x61c08b60
y.create.l HWIO_OXILI_SP_VS_LENGTH_REG_CTX_0_ADDR A:0x61c08b7c
y.create.l HWIO_OXILI_SP_FS_CTRL_REG0_CTX_0_ADDR A:0x61c08b80
y.create.l HWIO_OXILI_SP_FS_CTRL_REG1_CTX_0_ADDR A:0x61c08b84
y.create.l HWIO_OXILI_SP_FS_OBJ_OFFSET_REG_CTX_0_ADDR A:0x61c08b88
y.create.l HWIO_OXILI_SP_FS_OBJ_START_REG_CTX_0_ADDR A:0x61c08b8c
y.create.l HWIO_OXILI_SP_FS_PVT_MEM_PARAM_REG_CTX_0_ADDR A:0x61c08b90
y.create.l HWIO_OXILI_SP_FS_PVT_MEM_ADDR_REG_CTX_0_ADDR A:0x61c08b94
y.create.l HWIO_OXILI_SP_FS_PVT_MEM_SIZE_REG_CTX_0_ADDR A:0x61c08b98
y.create.l HWIO_OXILI_SP_FS_FLAT_SHAD_MODE_REG_0_CTX_0_ADDR A:0x61c08ba0
y.create.l HWIO_OXILI_SP_FS_FLAT_SHAD_MODE_REG_1_CTX_0_ADDR A:0x61c08ba4
y.create.l HWIO_OXILI_SP_FS_OUTPUT_REG_CTX_0_ADDR A:0x61c08bb0
y.create.l HWIO_OXILI_SP_FS_MRT_REG_0_CTX_0_ADDR A:0x61c08bc0
y.create.l HWIO_OXILI_SP_FS_MRT_REG_1_CTX_0_ADDR A:0x61c08bc4
y.create.l HWIO_OXILI_SP_FS_MRT_REG_2_CTX_0_ADDR A:0x61c08bc8
y.create.l HWIO_OXILI_SP_FS_MRT_REG_3_CTX_0_ADDR A:0x61c08bcc
y.create.l HWIO_OXILI_SP_FS_IMAGE_OUTPUT_REG_0_CTX_0_ADDR A:0x61c08bd0
y.create.l HWIO_OXILI_SP_FS_IMAGE_OUTPUT_REG_1_CTX_0_ADDR A:0x61c08bd4
y.create.l HWIO_OXILI_SP_FS_IMAGE_OUTPUT_REG_2_CTX_0_ADDR A:0x61c08bd8
y.create.l HWIO_OXILI_SP_FS_IMAGE_OUTPUT_REG_3_CTX_0_ADDR A:0x61c08bdc
y.create.l HWIO_OXILI_SP_FS_LENGTH_REG_CTX_0_ADDR A:0x61c08bfc
y.create.l HWIO_OXILI_SP_VS_INSTR_PORT_REG_CTX_0_ADDR A:0x61c08c00
y.create.l HWIO_OXILI_SP_FS_INSTR_PORT_REG_CTX_0_ADDR A:0x61c08c10
y.create.l HWIO_OXILI_SP_VS_CONST_PORT_REG_CTX_0_ADDR A:0x61c08c20
y.create.l HWIO_OXILI_SP_FS_CONST_PORT_REG_CTX_0_ADDR A:0x61c08c30
y.create.l HWIO_OXILI_SP_SP_CTRL_REG_CTX_1_ADDR A:0x61c09b00
y.create.l HWIO_OXILI_SP_VS_CTRL_REG0_CTX_1_ADDR A:0x61c09b10
y.create.l HWIO_OXILI_SP_VS_CTRL_REG1_CTX_1_ADDR A:0x61c09b14
y.create.l HWIO_OXILI_SP_VS_PARAM_REG_CTX_1_ADDR A:0x61c09b18
y.create.l HWIO_OXILI_SP_VS_OUT_REG_0_CTX_1_ADDR A:0x61c09b1c
y.create.l HWIO_OXILI_SP_VS_OUT_REG_1_CTX_1_ADDR A:0x61c09b20
y.create.l HWIO_OXILI_SP_VS_OUT_REG_2_CTX_1_ADDR A:0x61c09b24
y.create.l HWIO_OXILI_SP_VS_OUT_REG_3_CTX_1_ADDR A:0x61c09b28
y.create.l HWIO_OXILI_SP_VS_OUT_REG_4_CTX_1_ADDR A:0x61c09b2c
y.create.l HWIO_OXILI_SP_VS_OUT_REG_5_CTX_1_ADDR A:0x61c09b30
y.create.l HWIO_OXILI_SP_VS_OUT_REG_6_CTX_1_ADDR A:0x61c09b34
y.create.l HWIO_OXILI_SP_VS_OUT_REG_7_CTX_1_ADDR A:0x61c09b38
y.create.l HWIO_OXILI_SP_VS_VPC_DST_REG_0_CTX_1_ADDR A:0x61c09b40
y.create.l HWIO_OXILI_SP_VS_VPC_DST_REG_1_CTX_1_ADDR A:0x61c09b44
y.create.l HWIO_OXILI_SP_VS_VPC_DST_REG_2_CTX_1_ADDR A:0x61c09b48
y.create.l HWIO_OXILI_SP_VS_VPC_DST_REG_3_CTX_1_ADDR A:0x61c09b4c
y.create.l HWIO_OXILI_SP_VS_OBJ_OFFSET_REG_CTX_1_ADDR A:0x61c09b50
y.create.l HWIO_OXILI_SP_VS_OBJ_START_REG_CTX_1_ADDR A:0x61c09b54
y.create.l HWIO_OXILI_SP_VS_PVT_MEM_PARAM_REG_CTX_1_ADDR A:0x61c09b58
y.create.l HWIO_OXILI_SP_VS_PVT_MEM_ADDR_REG_CTX_1_ADDR A:0x61c09b5c
y.create.l HWIO_OXILI_SP_VS_PVT_MEM_SIZE_REG_CTX_1_ADDR A:0x61c09b60
y.create.l HWIO_OXILI_SP_VS_LENGTH_REG_CTX_1_ADDR A:0x61c09b7c
y.create.l HWIO_OXILI_SP_FS_CTRL_REG0_CTX_1_ADDR A:0x61c09b80
y.create.l HWIO_OXILI_SP_FS_CTRL_REG1_CTX_1_ADDR A:0x61c09b84
y.create.l HWIO_OXILI_SP_FS_OBJ_OFFSET_REG_CTX_1_ADDR A:0x61c09b88
y.create.l HWIO_OXILI_SP_FS_OBJ_START_REG_CTX_1_ADDR A:0x61c09b8c
y.create.l HWIO_OXILI_SP_FS_PVT_MEM_PARAM_REG_CTX_1_ADDR A:0x61c09b90
y.create.l HWIO_OXILI_SP_FS_PVT_MEM_ADDR_REG_CTX_1_ADDR A:0x61c09b94
y.create.l HWIO_OXILI_SP_FS_PVT_MEM_SIZE_REG_CTX_1_ADDR A:0x61c09b98
y.create.l HWIO_OXILI_SP_FS_FLAT_SHAD_MODE_REG_0_CTX_1_ADDR A:0x61c09ba0
y.create.l HWIO_OXILI_SP_FS_FLAT_SHAD_MODE_REG_1_CTX_1_ADDR A:0x61c09ba4
y.create.l HWIO_OXILI_SP_FS_OUTPUT_REG_CTX_1_ADDR A:0x61c09bb0
y.create.l HWIO_OXILI_SP_FS_MRT_REG_0_CTX_1_ADDR A:0x61c09bc0
y.create.l HWIO_OXILI_SP_FS_MRT_REG_1_CTX_1_ADDR A:0x61c09bc4
y.create.l HWIO_OXILI_SP_FS_MRT_REG_2_CTX_1_ADDR A:0x61c09bc8
y.create.l HWIO_OXILI_SP_FS_MRT_REG_3_CTX_1_ADDR A:0x61c09bcc
y.create.l HWIO_OXILI_SP_FS_IMAGE_OUTPUT_REG_0_CTX_1_ADDR A:0x61c09bd0
y.create.l HWIO_OXILI_SP_FS_IMAGE_OUTPUT_REG_1_CTX_1_ADDR A:0x61c09bd4
y.create.l HWIO_OXILI_SP_FS_IMAGE_OUTPUT_REG_2_CTX_1_ADDR A:0x61c09bd8
y.create.l HWIO_OXILI_SP_FS_IMAGE_OUTPUT_REG_3_CTX_1_ADDR A:0x61c09bdc
y.create.l HWIO_OXILI_SP_FS_LENGTH_REG_CTX_1_ADDR A:0x61c09bfc
y.create.l HWIO_OXILI_SP_VS_INSTR_PORT_REG_CTX_1_ADDR A:0x61c09c00
y.create.l HWIO_OXILI_SP_FS_INSTR_PORT_REG_CTX_1_ADDR A:0x61c09c10
y.create.l HWIO_OXILI_SP_VS_CONST_PORT_REG_CTX_1_ADDR A:0x61c09c20
y.create.l HWIO_OXILI_SP_FS_CONST_PORT_REG_CTX_1_ADDR A:0x61c09c30
y.create.l HWIO_OXILI_TPL1_TP_DEBUG_ECO_ADDR A:0x61c03c00
y.create.l HWIO_OXILI_TPL1_TP_STATUS0_ADDR A:0x61c03c04
y.create.l HWIO_OXILI_TPL1_TP_MODE_CONTROL_ADDR A:0x61c03c0c
y.create.l HWIO_OXILI_TPL1_TP_PERFCOUNTER0_SELECT_ADDR A:0x61c03c10
y.create.l HWIO_OXILI_TPL1_TP_PERFCOUNTER1_SELECT_ADDR A:0x61c03c14
y.create.l HWIO_OXILI_TPL1_TP_PERFCOUNTER2_SELECT_ADDR A:0x61c03c18
y.create.l HWIO_OXILI_TPL1_TP_PERFCOUNTER3_SELECT_ADDR A:0x61c03c1c
y.create.l HWIO_OXILI_TPL1_TP_PERFCOUNTER4_SELECT_ADDR A:0x61c03c20
y.create.l HWIO_OXILI_TPL1_TP_PERFCOUNTER5_SELECT_ADDR A:0x61c03c24
y.create.l HWIO_OXILI_TPL1_TP_VS_TEX_OFFSET_CTX_0_ADDR A:0x61c08d00
y.create.l HWIO_OXILI_TPL1_TP_FS_TEX_OFFSET_CTX_0_ADDR A:0x61c08d08
y.create.l HWIO_OXILI_TPL1_TP_VS_BORDER_COLOR_BASE_ADDR_CTX_0_ADDR A:0x61c08d04
y.create.l HWIO_OXILI_TPL1_TP_FS_BORDER_COLOR_BASE_ADDR_CTX_0_ADDR A:0x61c08d0c
y.create.l HWIO_OXILI_TPL1_TP_SAMPLER_0_CTX_0_ADDR A:0x61c08d20
y.create.l HWIO_OXILI_TPL1_TP_SAMPLER_1_CTX_0_ADDR A:0x61c08d24
y.create.l HWIO_OXILI_TPL1_TP_TEXMEM_OBJ_0_CTX_0_ADDR A:0x61c08d40
y.create.l HWIO_OXILI_TPL1_TP_TEXMEM_OBJ_1_CTX_0_ADDR A:0x61c08d44
y.create.l HWIO_OXILI_TPL1_TP_TEXMEM_OBJ_2_CTX_0_ADDR A:0x61c08d48
y.create.l HWIO_OXILI_TPL1_TP_TEXMEM_OBJ_3_CTX_0_ADDR A:0x61c08d4c
y.create.l HWIO_OXILI_TPL1_TP_TEXMEM_OBJ_4_CTX_0_ADDR A:0x61c08d50
y.create.l HWIO_OXILI_TPL1_TP_TEXMEM_OBJ_5_CTX_0_ADDR A:0x61c08d54
y.create.l HWIO_OXILI_TPL1_TP_TEXMEM_OBJ_6_CTX_0_ADDR A:0x61c08d58
y.create.l HWIO_OXILI_TPL1_MIPMAP_ADDR_PORT_REG_CTX_0_ADDR A:0x61c08d80
y.create.l HWIO_OXILI_TPL1_TP_VS_TEX_OFFSET_CTX_1_ADDR A:0x61c09d00
y.create.l HWIO_OXILI_TPL1_TP_FS_TEX_OFFSET_CTX_1_ADDR A:0x61c09d08
y.create.l HWIO_OXILI_TPL1_TP_VS_BORDER_COLOR_BASE_ADDR_CTX_1_ADDR A:0x61c09d04
y.create.l HWIO_OXILI_TPL1_TP_FS_BORDER_COLOR_BASE_ADDR_CTX_1_ADDR A:0x61c09d0c
y.create.l HWIO_OXILI_TPL1_TP_SAMPLER_0_CTX_1_ADDR A:0x61c09d20
y.create.l HWIO_OXILI_TPL1_TP_SAMPLER_1_CTX_1_ADDR A:0x61c09d24
y.create.l HWIO_OXILI_TPL1_TP_TEXMEM_OBJ_0_CTX_1_ADDR A:0x61c09d40
y.create.l HWIO_OXILI_TPL1_TP_TEXMEM_OBJ_1_CTX_1_ADDR A:0x61c09d44
y.create.l HWIO_OXILI_TPL1_TP_TEXMEM_OBJ_2_CTX_1_ADDR A:0x61c09d48
y.create.l HWIO_OXILI_TPL1_TP_TEXMEM_OBJ_3_CTX_1_ADDR A:0x61c09d4c
y.create.l HWIO_OXILI_TPL1_TP_TEXMEM_OBJ_4_CTX_1_ADDR A:0x61c09d50
y.create.l HWIO_OXILI_TPL1_TP_TEXMEM_OBJ_5_CTX_1_ADDR A:0x61c09d54
y.create.l HWIO_OXILI_TPL1_TP_TEXMEM_OBJ_6_CTX_1_ADDR A:0x61c09d58
y.create.l HWIO_OXILI_TPL1_MIPMAP_ADDR_PORT_REG_CTX_1_ADDR A:0x61c09d80
y.create.l HWIO_OXILI_RB_GMEM_BASE_ADDR_ADDR A:0x61c03300
y.create.l HWIO_OXILI_RB_DEBUG_ECO_CONTROLS_ADDR_ADDR A:0x61c03304
y.create.l HWIO_OXILI_RB_PERF_COUNTER0_SEL_ADDR A:0x61c03318
y.create.l HWIO_OXILI_RB_PERF_COUNTER1_SEL_ADDR A:0x61c0331c
y.create.l HWIO_OXILI_RB_FRAME_BUFFER_DIMENSION_ADDR A:0x61c03380
y.create.l HWIO_OXILI_RB_MARB_POWER_COUNTER_LOW_ADDR A:0x61c03390
y.create.l HWIO_OXILI_RB_MARB_POWER_COUNTER_HI_ADDR A:0x61c03394
y.create.l HWIO_OXILI_RB_MODE_CONTROL_CTX_0_ADDR A:0x61c08300
y.create.l HWIO_OXILI_RB_RENDER_CONTROL_CTX_0_ADDR A:0x61c08304
y.create.l HWIO_OXILI_RB_MSAA_CONTROL_CTX_0_ADDR A:0x61c08308
y.create.l HWIO_OXILI_RB_ALPHA_REFERENCE_CTX_0_ADDR A:0x61c0830c
y.create.l HWIO_OXILI_RB_MRT_CONTROL0_CTX_0_ADDR A:0x61c08310
y.create.l HWIO_OXILI_RB_MRT_CONTROL1_CTX_0_ADDR A:0x61c08320
y.create.l HWIO_OXILI_RB_MRT_CONTROL2_CTX_0_ADDR A:0x61c08330
y.create.l HWIO_OXILI_RB_MRT_CONTROL3_CTX_0_ADDR A:0x61c08340
y.create.l HWIO_OXILI_RB_MRT_BUF_INFO0_CTX_0_ADDR A:0x61c08314
y.create.l HWIO_OXILI_RB_MRT_BUF_INFO1_CTX_0_ADDR A:0x61c08324
y.create.l HWIO_OXILI_RB_MRT_BUF_INFO2_CTX_0_ADDR A:0x61c08334
y.create.l HWIO_OXILI_RB_MRT_BUF_INFO3_CTX_0_ADDR A:0x61c08344
y.create.l HWIO_OXILI_RB_MRT_BUF_BASE0_CTX_0_ADDR A:0x61c08318
y.create.l HWIO_OXILI_RB_MRT_BUF_BASE1_CTX_0_ADDR A:0x61c08328
y.create.l HWIO_OXILI_RB_MRT_BUF_BASE2_CTX_0_ADDR A:0x61c08338
y.create.l HWIO_OXILI_RB_MRT_BUF_BASE3_CTX_0_ADDR A:0x61c08348
y.create.l HWIO_OXILI_RB_MRT_BLEND_CONTROL0_CTX_0_ADDR A:0x61c0831c
y.create.l HWIO_OXILI_RB_MRT_BLEND_CONTROL1_CTX_0_ADDR A:0x61c0832c
y.create.l HWIO_OXILI_RB_MRT_BLEND_CONTROL2_CTX_0_ADDR A:0x61c0833c
y.create.l HWIO_OXILI_RB_MRT_BLEND_CONTROL3_CTX_0_ADDR A:0x61c0834c
y.create.l HWIO_OXILI_RB_BLEND_RED_CTX_0_ADDR A:0x61c08390
y.create.l HWIO_OXILI_RB_BLEND_GREEN_CTX_0_ADDR A:0x61c08394
y.create.l HWIO_OXILI_RB_BLEND_BLUE_CTX_0_ADDR A:0x61c08398
y.create.l HWIO_OXILI_RB_BLEND_ALPHA_CTX_0_ADDR A:0x61c0839c
y.create.l HWIO_OXILI_RB_CLEAR_COLOR_DW0_CTX_0_ADDR A:0x61c083a0
y.create.l HWIO_OXILI_RB_CLEAR_COLOR_DW1_CTX_0_ADDR A:0x61c083a4
y.create.l HWIO_OXILI_RB_CLEAR_COLOR_DW2_CTX_0_ADDR A:0x61c083a8
y.create.l HWIO_OXILI_RB_CLEAR_COLOR_DW3_CTX_0_ADDR A:0x61c083ac
y.create.l HWIO_OXILI_RB_COPY_CONTROL_CTX_0_ADDR A:0x61c083b0
y.create.l HWIO_OXILI_RB_COPY_DEST_BASE_CTX_0_ADDR A:0x61c083b4
y.create.l HWIO_OXILI_RB_COPY_DEST_PITCH_CTX_0_ADDR A:0x61c083b8
y.create.l HWIO_OXILI_RB_COPY_DEST_INFO_CTX_0_ADDR A:0x61c083bc
y.create.l HWIO_OXILI_RB_DEPTH_CONTROL_CTX_0_ADDR A:0x61c08400
y.create.l HWIO_OXILI_RB_DEPTH_CLEAR_CTX_0_ADDR A:0x61c08404
y.create.l HWIO_OXILI_RB_DEPTH_BUF_INFO_CTX_0_ADDR A:0x61c08408
y.create.l HWIO_OXILI_RB_DEPTH_BUF_PITCH_CTX_0_ADDR A:0x61c0840c
y.create.l HWIO_OXILI_RB_STENCIL_CONTROL_CTX_0_ADDR A:0x61c08410
y.create.l HWIO_OXILI_RB_STENCIL_CLEAR_CTX_0_ADDR A:0x61c08414
y.create.l HWIO_OXILI_RB_STENCIL_BUF_INFO_CTX_0_ADDR A:0x61c08418
y.create.l HWIO_OXILI_RB_STENCIL_BUF_PITCH_CTX_0_ADDR A:0x61c0841c
y.create.l HWIO_OXILI_RB_STENCIL_REF_MASK_CTX_0_ADDR A:0x61c08420
y.create.l HWIO_OXILI_RB_STENCIL_REF_MASK_BF_CTX_0_ADDR A:0x61c08424
y.create.l HWIO_OXILI_RB_LRZ_VSC_CONTROL_CTX_0_ADDR A:0x61c08430
y.create.l HWIO_OXILI_RB_WINDOW_OFFSET_CTX_0_ADDR A:0x61c08438
y.create.l HWIO_OXILI_RB_SAMPLE_COUNT_CONTROL_CTX_0_ADDR A:0x61c08440
y.create.l HWIO_OXILI_RB_SAMPLE_COUNT_ADDR_CTX_0_ADDR A:0x61c08444
y.create.l HWIO_OXILI_RB_Z_CLAMP_MIN_CTX_0_ADDR A:0x61c08450
y.create.l HWIO_OXILI_RB_Z_CLAMP_MAX_CTX_0_ADDR A:0x61c08454
y.create.l HWIO_OXILI_RB_MODE_CONTROL_CTX_1_ADDR A:0x61c09300
y.create.l HWIO_OXILI_RB_RENDER_CONTROL_CTX_1_ADDR A:0x61c09304
y.create.l HWIO_OXILI_RB_MSAA_CONTROL_CTX_1_ADDR A:0x61c09308
y.create.l HWIO_OXILI_RB_ALPHA_REFERENCE_CTX_1_ADDR A:0x61c0930c
y.create.l HWIO_OXILI_RB_MRT_CONTROL0_CTX_1_ADDR A:0x61c09310
y.create.l HWIO_OXILI_RB_MRT_CONTROL1_CTX_1_ADDR A:0x61c09320
y.create.l HWIO_OXILI_RB_MRT_CONTROL2_CTX_1_ADDR A:0x61c09330
y.create.l HWIO_OXILI_RB_MRT_CONTROL3_CTX_1_ADDR A:0x61c09340
y.create.l HWIO_OXILI_RB_MRT_BUF_INFO0_CTX_1_ADDR A:0x61c09314
y.create.l HWIO_OXILI_RB_MRT_BUF_INFO1_CTX_1_ADDR A:0x61c09324
y.create.l HWIO_OXILI_RB_MRT_BUF_INFO2_CTX_1_ADDR A:0x61c09334
y.create.l HWIO_OXILI_RB_MRT_BUF_INFO3_CTX_1_ADDR A:0x61c09344
y.create.l HWIO_OXILI_RB_MRT_BUF_BASE0_CTX_1_ADDR A:0x61c09318
y.create.l HWIO_OXILI_RB_MRT_BUF_BASE1_CTX_1_ADDR A:0x61c09328
y.create.l HWIO_OXILI_RB_MRT_BUF_BASE2_CTX_1_ADDR A:0x61c09338
y.create.l HWIO_OXILI_RB_MRT_BUF_BASE3_CTX_1_ADDR A:0x61c09348
y.create.l HWIO_OXILI_RB_MRT_BLEND_CONTROL0_CTX_1_ADDR A:0x61c0931c
y.create.l HWIO_OXILI_RB_MRT_BLEND_CONTROL1_CTX_1_ADDR A:0x61c0932c
y.create.l HWIO_OXILI_RB_MRT_BLEND_CONTROL2_CTX_1_ADDR A:0x61c0933c
y.create.l HWIO_OXILI_RB_MRT_BLEND_CONTROL3_CTX_1_ADDR A:0x61c0934c
y.create.l HWIO_OXILI_RB_BLEND_RED_CTX_1_ADDR A:0x61c09390
y.create.l HWIO_OXILI_RB_BLEND_GREEN_CTX_1_ADDR A:0x61c09394
y.create.l HWIO_OXILI_RB_BLEND_BLUE_CTX_1_ADDR A:0x61c09398
y.create.l HWIO_OXILI_RB_BLEND_ALPHA_CTX_1_ADDR A:0x61c0939c
y.create.l HWIO_OXILI_RB_CLEAR_COLOR_DW0_CTX_1_ADDR A:0x61c093a0
y.create.l HWIO_OXILI_RB_CLEAR_COLOR_DW1_CTX_1_ADDR A:0x61c093a4
y.create.l HWIO_OXILI_RB_CLEAR_COLOR_DW2_CTX_1_ADDR A:0x61c093a8
y.create.l HWIO_OXILI_RB_CLEAR_COLOR_DW3_CTX_1_ADDR A:0x61c093ac
y.create.l HWIO_OXILI_RB_COPY_CONTROL_CTX_1_ADDR A:0x61c093b0
y.create.l HWIO_OXILI_RB_COPY_DEST_BASE_CTX_1_ADDR A:0x61c093b4
y.create.l HWIO_OXILI_RB_COPY_DEST_PITCH_CTX_1_ADDR A:0x61c093b8
y.create.l HWIO_OXILI_RB_COPY_DEST_INFO_CTX_1_ADDR A:0x61c093bc
y.create.l HWIO_OXILI_RB_DEPTH_CONTROL_CTX_1_ADDR A:0x61c09400
y.create.l HWIO_OXILI_RB_DEPTH_CLEAR_CTX_1_ADDR A:0x61c09404
y.create.l HWIO_OXILI_RB_DEPTH_BUF_INFO_CTX_1_ADDR A:0x61c09408
y.create.l HWIO_OXILI_RB_DEPTH_BUF_PITCH_CTX_1_ADDR A:0x61c0940c
y.create.l HWIO_OXILI_RB_STENCIL_CONTROL_CTX_1_ADDR A:0x61c09410
y.create.l HWIO_OXILI_RB_STENCIL_CLEAR_CTX_1_ADDR A:0x61c09414
y.create.l HWIO_OXILI_RB_STENCIL_BUF_INFO_CTX_1_ADDR A:0x61c09418
y.create.l HWIO_OXILI_RB_STENCIL_BUF_PITCH_CTX_1_ADDR A:0x61c0941c
y.create.l HWIO_OXILI_RB_STENCIL_REF_MASK_CTX_1_ADDR A:0x61c09420
y.create.l HWIO_OXILI_RB_STENCIL_REF_MASK_BF_CTX_1_ADDR A:0x61c09424
y.create.l HWIO_OXILI_RB_LRZ_VSC_CONTROL_CTX_1_ADDR A:0x61c09430
y.create.l HWIO_OXILI_RB_WINDOW_OFFSET_CTX_1_ADDR A:0x61c09438
y.create.l HWIO_OXILI_RB_SAMPLE_COUNT_CONTROL_CTX_1_ADDR A:0x61c09440
y.create.l HWIO_OXILI_RB_SAMPLE_COUNT_ADDR_CTX_1_ADDR A:0x61c09444
y.create.l HWIO_OXILI_RB_Z_CLAMP_MIN_CTX_1_ADDR A:0x61c09450
y.create.l HWIO_OXILI_RB_Z_CLAMP_MAX_CTX_1_ADDR A:0x61c09454
y.create.l HWIO_OXILI_VSC_BIN_SIZE_ADDR A:0x61c03004
y.create.l HWIO_OXILI_VSC_PIPE_CONFIG_0_ADDR A:0x61c03018
y.create.l HWIO_OXILI_VSC_PIPE_CONFIG_1_ADDR A:0x61c03024
y.create.l HWIO_OXILI_VSC_PIPE_CONFIG_2_ADDR A:0x61c03030
y.create.l HWIO_OXILI_VSC_PIPE_CONFIG_3_ADDR A:0x61c0303c
y.create.l HWIO_OXILI_VSC_PIPE_CONFIG_4_ADDR A:0x61c03048
y.create.l HWIO_OXILI_VSC_PIPE_CONFIG_5_ADDR A:0x61c03054
y.create.l HWIO_OXILI_VSC_PIPE_CONFIG_6_ADDR A:0x61c03060
y.create.l HWIO_OXILI_VSC_PIPE_CONFIG_7_ADDR A:0x61c0306c
y.create.l HWIO_OXILI_VSC_PIPE_DATA_ADDRESS_0_ADDR A:0x61c0301c
y.create.l HWIO_OXILI_VSC_PIPE_DATA_ADDRESS_1_ADDR A:0x61c03028
y.create.l HWIO_OXILI_VSC_PIPE_DATA_ADDRESS_2_ADDR A:0x61c03034
y.create.l HWIO_OXILI_VSC_PIPE_DATA_ADDRESS_3_ADDR A:0x61c03040
y.create.l HWIO_OXILI_VSC_PIPE_DATA_ADDRESS_4_ADDR A:0x61c0304c
y.create.l HWIO_OXILI_VSC_PIPE_DATA_ADDRESS_5_ADDR A:0x61c03058
y.create.l HWIO_OXILI_VSC_PIPE_DATA_ADDRESS_6_ADDR A:0x61c03064
y.create.l HWIO_OXILI_VSC_PIPE_DATA_ADDRESS_7_ADDR A:0x61c03070
y.create.l HWIO_OXILI_VSC_PIPE_DATA_LENGTH_0_ADDR A:0x61c03020
y.create.l HWIO_OXILI_VSC_PIPE_DATA_LENGTH_1_ADDR A:0x61c0302c
y.create.l HWIO_OXILI_VSC_PIPE_DATA_LENGTH_2_ADDR A:0x61c03038
y.create.l HWIO_OXILI_VSC_PIPE_DATA_LENGTH_3_ADDR A:0x61c03044
y.create.l HWIO_OXILI_VSC_PIPE_DATA_LENGTH_4_ADDR A:0x61c03050
y.create.l HWIO_OXILI_VSC_PIPE_DATA_LENGTH_5_ADDR A:0x61c0305c
y.create.l HWIO_OXILI_VSC_PIPE_DATA_LENGTH_6_ADDR A:0x61c03068
y.create.l HWIO_OXILI_VSC_PIPE_DATA_LENGTH_7_ADDR A:0x61c03074
y.create.l HWIO_OXILI_VSC_SIZE_ADDRESS_ADDR A:0x61c03008
y.create.l HWIO_OXILI_VSC_VSC_DEBUG_CONTROL_CTX_0_ADDR A:0x61c03460
y.create.l HWIO_OXILI_VBIF_VERSION_ADDR A:0x61c0c000
y.create.l HWIO_OXILI_VBIF_CLKON_ADDR A:0x61c0c004
y.create.l HWIO_OXILI_VBIF_CLK_FORCE_CTRL0_ADDR A:0x61c0c008
y.create.l HWIO_OXILI_VBIF_CLK_FORCE_CTRL1_ADDR A:0x61c0c00c
y.create.l HWIO_OXILI_VBIF_QOS_OVERRIDE_EN_ADDR A:0x61c0c010
y.create.l HWIO_OXILI_VBIF_PRILVL_ACT_PROP_EN_ADDR A:0x61c0c014
y.create.l HWIO_OXILI_VBIF_QOS_OVERRIDE_REQPRI_ADDR A:0x61c0c018
y.create.l HWIO_OXILI_VBIF_QOS_OVERRIDE_PRILVL_ADDR A:0x61c0c01c
y.create.l HWIO_OXILI_VBIF_QOS_REMAP_00_ADDR A:0x61c0c020
y.create.l HWIO_OXILI_VBIF_QOS_REMAP_01_ADDR A:0x61c0c024
y.create.l HWIO_OXILI_VBIF_QOS_REMAP_10_ADDR A:0x61c0c028
y.create.l HWIO_OXILI_VBIF_QOS_REMAP_11_ADDR A:0x61c0c02c
y.create.l HWIO_OXILI_VBIF_WRITE_GATHER_EN_ADDR A:0x61c0c0ac
y.create.l HWIO_OXILI_VBIF_IN_RD_LIM_CONF0_ADDR A:0x61c0c0b0
y.create.l HWIO_OXILI_VBIF_IN_WR_LIM_CONF0_ADDR A:0x61c0c0c0
y.create.l HWIO_OXILI_VBIF_OUT_RD_LIM_CONF0_ADDR A:0x61c0c0d0
y.create.l HWIO_OXILI_VBIF_OUT_WR_LIM_CONF0_ADDR A:0x61c0c0d4
y.create.l HWIO_OXILI_VBIF_DDR_OUT_MAX_BURST_ADDR A:0x61c0c0d8
y.create.l HWIO_OXILI_VBIF_ISO_SYNC_ADDR A:0x61c0c0e0
y.create.l HWIO_OXILI_VBIF_ARB_CTL_ADDR A:0x61c0c0f0
y.create.l HWIO_OXILI_VBIF_DDR_ARB_CONF0_ADDR A:0x61c0c0f4
y.create.l HWIO_OXILI_VBIF_FIXED_ARB_CONF0_ADDR A:0x61c0c100
y.create.l HWIO_OXILI_VBIF_ROUND_ROBIN_QOS_ARB_ADDR A:0x61c0c124
y.create.l HWIO_OXILI_VBIF_OUT_AXI_AMEMTYPE_CONF0_ADDR A:0x61c0c160
y.create.l HWIO_OXILI_VBIF_OUT_AXI_AINST_OVERRIDE_EN_ADDR A:0x61c0c168
y.create.l HWIO_OXILI_VBIF_OUT_AXI_AINST_ADDR A:0x61c0c16c
y.create.l HWIO_OXILI_VBIF_OUT_AXI_ASHARED_ADDR A:0x61c0c170
y.create.l HWIO_OXILI_VBIF_OUT_AXI_AINNERSHARED_ADDR A:0x61c0c174
y.create.l HWIO_OXILI_VBIF_OUT_AXI_AOOO_EN_ADDR A:0x61c0c178
y.create.l HWIO_OXILI_VBIF_OUT_AXI_AOOO_ADDR A:0x61c0c17c
y.create.l HWIO_OXILI_VBIF_OUT_AXI_ANOALLOCATE_ADDR A:0x61c0c180
y.create.l HWIO_OXILI_VBIF_WD_TIMEOUT_ADDR A:0x61c0c184
y.create.l HWIO_OXILI_VBIF_PND_ERR_ADDR A:0x61c0c190
y.create.l HWIO_OXILI_VBIF_SRC_ERR_ADDR A:0x61c0c194
y.create.l HWIO_OXILI_VBIF_ERR_MASK_ADDR A:0x61c0c198
y.create.l HWIO_OXILI_VBIF_ERR_CLR_ADDR A:0x61c0c19c
y.create.l HWIO_OXILI_VBIF_ERR_INFO_ADDR A:0x61c0c1a0
y.create.l HWIO_OXILI_VBIF_AXI_TEST_CTL_ADDR A:0x61c0c1b0
y.create.l HWIO_OXILI_VBIF_AXI_TEST_OUT_ADDR A:0x61c0c1b4
y.create.l HWIO_OXILI_VBIF_XIN_HALT_CTRL0_ADDR A:0x61c0c200
y.create.l HWIO_OXILI_VBIF_XIN_HALT_CTRL1_ADDR A:0x61c0c204
y.create.l HWIO_OXILI_VBIF_AXI_HALT_CTRL0_ADDR A:0x61c0c208
y.create.l HWIO_OXILI_VBIF_AXI_HALT_CTRL1_ADDR A:0x61c0c20c
y.create.l HWIO_OXILI_VBIF_TEST_BUS_OUT_CTRL_ADDR A:0x61c0c210
y.create.l HWIO_OXILI_VBIF_TEST_BUS1_CTRL0_ADDR A:0x61c0c214
y.create.l HWIO_OXILI_VBIF_TEST_BUS1_CTRL1_ADDR A:0x61c0c218
y.create.l HWIO_OXILI_VBIF_TEST_BUS2_CTRL0_ADDR A:0x61c0c21c
y.create.l HWIO_OXILI_VBIF_TEST_BUS2_CTRL1_ADDR A:0x61c0c220
y.create.l HWIO_OXILI_VBIF_TEST_BUS_AHB_CTRL_ADDR A:0x61c0c22c
y.create.l HWIO_OXILI_VBIF_TEST_BUS_OUT_ADDR A:0x61c0c230
y.create.l HWIO_OXILI_VBIF_ATB_CONF0_ADDR A:0x61c0c240
y.create.l HWIO_OXILI_VBIF_ATB_CONF1_ADDR A:0x61c0c244
y.create.l HWIO_OXILI_VBIF_ATB_CONF2_ADDR A:0x61c0c248
y.create.l HWIO_OXILI_VBIF_ATB_CONF3_ADDR A:0x61c0c24c
y.create.l HWIO_OXILI_VBIF_ATB_TEST_VALUE_ADDR A:0x61c0c250
y.create.l HWIO_OXILI_VBIF_STM_CONF_ADDR A:0x61c0c260
y.create.l HWIO_OXILI_VBIF_WR_BUF_FOR_AP_ADDR A:0x61c0c270
y.create.l HWIO_OXILI_VBIF_PERF_CNT_EN0_ADDR A:0x61c0c300
y.create.l HWIO_OXILI_VBIF_PERF_CNT_EN1_ADDR A:0x61c0c304
y.create.l HWIO_OXILI_VBIF_PERF_CNT_EN2_ADDR A:0x61c0c308
y.create.l HWIO_OXILI_VBIF_PERF_CNT_EN3_ADDR A:0x61c0c30c
y.create.l HWIO_OXILI_VBIF_PERF_CNT_CLR0_ADDR A:0x61c0c320
y.create.l HWIO_OXILI_VBIF_PERF_CNT_CLR1_ADDR A:0x61c0c324
y.create.l HWIO_OXILI_VBIF_PERF_CNT_CLR2_ADDR A:0x61c0c328
y.create.l HWIO_OXILI_VBIF_PERF_CNT_CLR3_ADDR A:0x61c0c32c
y.create.l HWIO_OXILI_VBIF_PERF_CNT_SEL0_ADDR A:0x61c0c340
y.create.l HWIO_OXILI_VBIF_PERF_CNT_SEL1_ADDR A:0x61c0c344
y.create.l HWIO_OXILI_VBIF_PERF_CNT_SEL2_ADDR A:0x61c0c348
y.create.l HWIO_OXILI_VBIF_PERF_CNT_SEL3_ADDR A:0x61c0c34c
y.create.l HWIO_OXILI_VBIF_PERF_CNT_L0_ADDR A:0x61c0c360
y.create.l HWIO_OXILI_VBIF_PERF_CNT_L1_ADDR A:0x61c0c364
y.create.l HWIO_OXILI_VBIF_PERF_CNT_L2_ADDR A:0x61c0c368
y.create.l HWIO_OXILI_VBIF_PERF_CNT_L3_ADDR A:0x61c0c36c
y.create.l HWIO_OXILI_VBIF_PERF_CNT_H0_ADDR A:0x61c0c380
y.create.l HWIO_OXILI_VBIF_PERF_CNT_H1_ADDR A:0x61c0c384
y.create.l HWIO_OXILI_VBIF_PERF_CNT_H2_ADDR A:0x61c0c388
y.create.l HWIO_OXILI_VBIF_PERF_CNT_H3_ADDR A:0x61c0c38c
y.create.l HWIO_OXILI_VBIF_PERF_PWR_CNT_EN0_ADDR A:0x61c0c400
y.create.l HWIO_OXILI_VBIF_PERF_PWR_CNT_EN1_ADDR A:0x61c0c404
y.create.l HWIO_OXILI_VBIF_PERF_PWR_CNT_EN2_ADDR A:0x61c0c408
y.create.l HWIO_OXILI_VBIF_PERF_PWR_CNT_CLR0_ADDR A:0x61c0c420
y.create.l HWIO_OXILI_VBIF_PERF_PWR_CNT_CLR1_ADDR A:0x61c0c424
y.create.l HWIO_OXILI_VBIF_PERF_PWR_CNT_CLR2_ADDR A:0x61c0c428
y.create.l HWIO_OXILI_VBIF_PERF_PWR_CNT_L0_ADDR A:0x61c0c440
y.create.l HWIO_OXILI_VBIF_PERF_PWR_CNT_L1_ADDR A:0x61c0c444
y.create.l HWIO_OXILI_VBIF_PERF_PWR_CNT_L2_ADDR A:0x61c0c448
y.create.l HWIO_OXILI_VBIF_PERF_PWR_CNT_H0_ADDR A:0x61c0c460
y.create.l HWIO_OXILI_VBIF_PERF_PWR_CNT_H1_ADDR A:0x61c0c464
y.create.l HWIO_OXILI_VBIF_PERF_PWR_CNT_H2_ADDR A:0x61c0c468
y.create.l HWIO_OXILI_VBIF_MISR_CFG_A0_ADDR A:0x61c0c480
y.create.l HWIO_OXILI_VBIF_MISR_COUNTER_ADDR A:0x61c0c490
y.create.l HWIO_OXILI_VBIF_MISR_CLR_A0_ADDR A:0x61c0c494
y.create.l HWIO_OXILI_VBIF_MISR_A0_SIG0_ADDR A:0x61c0c4a4
y.create.l HWIO_OXILI_VBIF_MISR_A0_SIG1_ADDR A:0x61c0c4a8
y.create.l HWIO_OXILI_VBIF_MISR_A0_SIG2_ADDR A:0x61c0c4ac
y.create.l HWIO_OXILI_VBIF_MISR_A0_SIG3_ADDR A:0x61c0c4b0
y.create.l HWIO_OXILI_VBIF_ATB_EN_ADDR A:0x61c0d030
y.create.l HWIO_OXILI_VBIF_STM_EN_ADDR A:0x61c0d040
y.create.l HWIO_OXILI_VBIF_DDR_OUTPUT_RECOVERABLE_HALT_CTRL0_ADDR A:0x61c0e000
y.create.l HWIO_OXILI_VBIF_DDR_OUTPUT_RECOVERABLE_HALT_CTRL1_ADDR A:0x61c0e004
y.create.l HWIO_PCNOC_0_ABT_HW_VERSION_ADDR A:0x60023000
y.create.l HWIO_PCNOC_0_ABT_INST_ID_ADDR A:0x60023004
y.create.l HWIO_PCNOC_0_ABT_NUM_SLAVES_ADDR A:0x60023008
y.create.l HWIO_PCNOC_0_ABT_TIMER_LOADVAL_ADDR A:0x6002300c
y.create.l HWIO_PCNOC_0_ABT_TIMER_MODE_ADDR A:0x60023010
y.create.l HWIO_PCNOC_0_ABT_INTR_STATUS_ADDR A:0x60023014
y.create.l HWIO_PCNOC_0_ABT_INTR_CLEAR_ADDR A:0x60023018
y.create.l HWIO_PCNOC_0_ABT_INTR_ENABLE_ADDR A:0x6002301c
y.create.l HWIO_PCNOC_0_ABT_SYND_VALID_ADDR A:0x60023020
y.create.l HWIO_PCNOC_0_ABT_SYND_CLEAR_ADDR A:0x60023024
y.create.l HWIO_PCNOC_0_ABT_SYND_ID_ADDR A:0x60023028
y.create.l HWIO_PCNOC_0_ABT_SYND_ADDR0_ADDR A:0x6002302c
y.create.l HWIO_PCNOC_0_ABT_SYND_ADDR1_ADDR A:0x60023030
y.create.l HWIO_PCNOC_0_ABT_SYND_HREADY_ADDR A:0x60023034
y.create.l HWIO_PCNOC_1_ABT_HW_VERSION_ADDR A:0x60024000
y.create.l HWIO_PCNOC_1_ABT_INST_ID_ADDR A:0x60024004
y.create.l HWIO_PCNOC_1_ABT_NUM_SLAVES_ADDR A:0x60024008
y.create.l HWIO_PCNOC_1_ABT_TIMER_LOADVAL_ADDR A:0x6002400c
y.create.l HWIO_PCNOC_1_ABT_TIMER_MODE_ADDR A:0x60024010
y.create.l HWIO_PCNOC_1_ABT_INTR_STATUS_ADDR A:0x60024014
y.create.l HWIO_PCNOC_1_ABT_INTR_CLEAR_ADDR A:0x60024018
y.create.l HWIO_PCNOC_1_ABT_INTR_ENABLE_ADDR A:0x6002401c
y.create.l HWIO_PCNOC_1_ABT_SYND_VALID_ADDR A:0x60024020
y.create.l HWIO_PCNOC_1_ABT_SYND_CLEAR_ADDR A:0x60024024
y.create.l HWIO_PCNOC_1_ABT_SYND_ID_ADDR A:0x60024028
y.create.l HWIO_PCNOC_1_ABT_SYND_ADDR0_ADDR A:0x6002402c
y.create.l HWIO_PCNOC_1_ABT_SYND_ADDR1_ADDR A:0x60024030
y.create.l HWIO_PCNOC_1_ABT_SYND_HREADY_ADDR A:0x60024034
y.create.l HWIO_PCNOC_2_ABT_HW_VERSION_ADDR A:0x60025000
y.create.l HWIO_PCNOC_2_ABT_INST_ID_ADDR A:0x60025004
y.create.l HWIO_PCNOC_2_ABT_NUM_SLAVES_ADDR A:0x60025008
y.create.l HWIO_PCNOC_2_ABT_TIMER_LOADVAL_ADDR A:0x6002500c
y.create.l HWIO_PCNOC_2_ABT_TIMER_MODE_ADDR A:0x60025010
y.create.l HWIO_PCNOC_2_ABT_INTR_STATUS_ADDR A:0x60025014
y.create.l HWIO_PCNOC_2_ABT_INTR_CLEAR_ADDR A:0x60025018
y.create.l HWIO_PCNOC_2_ABT_INTR_ENABLE_ADDR A:0x6002501c
y.create.l HWIO_PCNOC_2_ABT_SYND_VALID_ADDR A:0x60025020
y.create.l HWIO_PCNOC_2_ABT_SYND_CLEAR_ADDR A:0x60025024
y.create.l HWIO_PCNOC_2_ABT_SYND_ID_ADDR A:0x60025028
y.create.l HWIO_PCNOC_2_ABT_SYND_ADDR0_ADDR A:0x6002502c
y.create.l HWIO_PCNOC_2_ABT_SYND_ADDR1_ADDR A:0x60025030
y.create.l HWIO_PCNOC_2_ABT_SYND_HREADY_ADDR A:0x60025034
y.create.l HWIO_PCNOC_3_ABT_HW_VERSION_ADDR A:0x60026000
y.create.l HWIO_PCNOC_3_ABT_INST_ID_ADDR A:0x60026004
y.create.l HWIO_PCNOC_3_ABT_NUM_SLAVES_ADDR A:0x60026008
y.create.l HWIO_PCNOC_3_ABT_TIMER_LOADVAL_ADDR A:0x6002600c
y.create.l HWIO_PCNOC_3_ABT_TIMER_MODE_ADDR A:0x60026010
y.create.l HWIO_PCNOC_3_ABT_INTR_STATUS_ADDR A:0x60026014
y.create.l HWIO_PCNOC_3_ABT_INTR_CLEAR_ADDR A:0x60026018
y.create.l HWIO_PCNOC_3_ABT_INTR_ENABLE_ADDR A:0x6002601c
y.create.l HWIO_PCNOC_3_ABT_SYND_VALID_ADDR A:0x60026020
y.create.l HWIO_PCNOC_3_ABT_SYND_CLEAR_ADDR A:0x60026024
y.create.l HWIO_PCNOC_3_ABT_SYND_ID_ADDR A:0x60026028
y.create.l HWIO_PCNOC_3_ABT_SYND_ADDR0_ADDR A:0x6002602c
y.create.l HWIO_PCNOC_3_ABT_SYND_ADDR1_ADDR A:0x60026030
y.create.l HWIO_PCNOC_3_ABT_SYND_HREADY_ADDR A:0x60026034
y.create.l HWIO_PCNOC_4_ABT_HW_VERSION_ADDR A:0x60027000
y.create.l HWIO_PCNOC_4_ABT_INST_ID_ADDR A:0x60027004
y.create.l HWIO_PCNOC_4_ABT_NUM_SLAVES_ADDR A:0x60027008
y.create.l HWIO_PCNOC_4_ABT_TIMER_LOADVAL_ADDR A:0x6002700c
y.create.l HWIO_PCNOC_4_ABT_TIMER_MODE_ADDR A:0x60027010
y.create.l HWIO_PCNOC_4_ABT_INTR_STATUS_ADDR A:0x60027014
y.create.l HWIO_PCNOC_4_ABT_INTR_CLEAR_ADDR A:0x60027018
y.create.l HWIO_PCNOC_4_ABT_INTR_ENABLE_ADDR A:0x6002701c
y.create.l HWIO_PCNOC_4_ABT_SYND_VALID_ADDR A:0x60027020
y.create.l HWIO_PCNOC_4_ABT_SYND_CLEAR_ADDR A:0x60027024
y.create.l HWIO_PCNOC_4_ABT_SYND_ID_ADDR A:0x60027028
y.create.l HWIO_PCNOC_4_ABT_SYND_ADDR0_ADDR A:0x6002702c
y.create.l HWIO_PCNOC_4_ABT_SYND_ADDR1_ADDR A:0x60027030
y.create.l HWIO_PCNOC_4_ABT_SYND_HREADY_ADDR A:0x60027034
y.create.l HWIO_PCNOC_5_ABT_HW_VERSION_ADDR A:0x60028000
y.create.l HWIO_PCNOC_5_ABT_INST_ID_ADDR A:0x60028004
y.create.l HWIO_PCNOC_5_ABT_NUM_SLAVES_ADDR A:0x60028008
y.create.l HWIO_PCNOC_5_ABT_TIMER_LOADVAL_ADDR A:0x6002800c
y.create.l HWIO_PCNOC_5_ABT_TIMER_MODE_ADDR A:0x60028010
y.create.l HWIO_PCNOC_5_ABT_INTR_STATUS_ADDR A:0x60028014
y.create.l HWIO_PCNOC_5_ABT_INTR_CLEAR_ADDR A:0x60028018
y.create.l HWIO_PCNOC_5_ABT_INTR_ENABLE_ADDR A:0x6002801c
y.create.l HWIO_PCNOC_5_ABT_SYND_VALID_ADDR A:0x60028020
y.create.l HWIO_PCNOC_5_ABT_SYND_CLEAR_ADDR A:0x60028024
y.create.l HWIO_PCNOC_5_ABT_SYND_ID_ADDR A:0x60028028
y.create.l HWIO_PCNOC_5_ABT_SYND_ADDR0_ADDR A:0x6002802c
y.create.l HWIO_PCNOC_5_ABT_SYND_ADDR1_ADDR A:0x60028030
y.create.l HWIO_PCNOC_5_ABT_SYND_HREADY_ADDR A:0x60028034
y.create.l HWIO_PCNOC_6_ABT_HW_VERSION_ADDR A:0x60029000
y.create.l HWIO_PCNOC_6_ABT_INST_ID_ADDR A:0x60029004
y.create.l HWIO_PCNOC_6_ABT_NUM_SLAVES_ADDR A:0x60029008
y.create.l HWIO_PCNOC_6_ABT_TIMER_LOADVAL_ADDR A:0x6002900c
y.create.l HWIO_PCNOC_6_ABT_TIMER_MODE_ADDR A:0x60029010
y.create.l HWIO_PCNOC_6_ABT_INTR_STATUS_ADDR A:0x60029014
y.create.l HWIO_PCNOC_6_ABT_INTR_CLEAR_ADDR A:0x60029018
y.create.l HWIO_PCNOC_6_ABT_INTR_ENABLE_ADDR A:0x6002901c
y.create.l HWIO_PCNOC_6_ABT_SYND_VALID_ADDR A:0x60029020
y.create.l HWIO_PCNOC_6_ABT_SYND_CLEAR_ADDR A:0x60029024
y.create.l HWIO_PCNOC_6_ABT_SYND_ID_ADDR A:0x60029028
y.create.l HWIO_PCNOC_6_ABT_SYND_ADDR0_ADDR A:0x6002902c
y.create.l HWIO_PCNOC_6_ABT_SYND_ADDR1_ADDR A:0x60029030
y.create.l HWIO_PCNOC_6_ABT_SYND_HREADY_ADDR A:0x60029034
y.create.l HWIO_PCNOC_7_ABT_HW_VERSION_ADDR A:0x6002a000
y.create.l HWIO_PCNOC_7_ABT_INST_ID_ADDR A:0x6002a004
y.create.l HWIO_PCNOC_7_ABT_NUM_SLAVES_ADDR A:0x6002a008
y.create.l HWIO_PCNOC_7_ABT_TIMER_LOADVAL_ADDR A:0x6002a00c
y.create.l HWIO_PCNOC_7_ABT_TIMER_MODE_ADDR A:0x6002a010
y.create.l HWIO_PCNOC_7_ABT_INTR_STATUS_ADDR A:0x6002a014
y.create.l HWIO_PCNOC_7_ABT_INTR_CLEAR_ADDR A:0x6002a018
y.create.l HWIO_PCNOC_7_ABT_INTR_ENABLE_ADDR A:0x6002a01c
y.create.l HWIO_PCNOC_7_ABT_SYND_VALID_ADDR A:0x6002a020
y.create.l HWIO_PCNOC_7_ABT_SYND_CLEAR_ADDR A:0x6002a024
y.create.l HWIO_PCNOC_7_ABT_SYND_ID_ADDR A:0x6002a028
y.create.l HWIO_PCNOC_7_ABT_SYND_ADDR0_ADDR A:0x6002a02c
y.create.l HWIO_PCNOC_7_ABT_SYND_ADDR1_ADDR A:0x6002a030
y.create.l HWIO_PCNOC_7_ABT_SYND_HREADY_ADDR A:0x6002a034
y.create.l HWIO_PCNOC_OBS_ID_COREID_ADDR A:0x60500000
y.create.l HWIO_PCNOC_OBS_ID_REVISIONID_ADDR A:0x60500004
y.create.l HWIO_PCNOC_OBS_FAULTEN_ADDR A:0x60500008
y.create.l HWIO_PCNOC_OBS_ERRVLD_ADDR A:0x6050000c
y.create.l HWIO_PCNOC_OBS_ERRCLR_ADDR A:0x60500010
y.create.l HWIO_PCNOC_OBS_ERRLOG0_ADDR A:0x60500014
y.create.l HWIO_PCNOC_OBS_ERRLOG1_ADDR A:0x60500018
y.create.l HWIO_PCNOC_OBS_ERRLOG3_ADDR A:0x60500020
y.create.l HWIO_PCNOC_OBS_ERRLOG4_ADDR A:0x60500024
y.create.l HWIO_PCNOC_OBS_ERRLOG5_ADDR A:0x60500028
y.create.l HWIO_PCNOC_OBS_DBG_ID_COREID_ADDR A:0x60500080
y.create.l HWIO_PCNOC_OBS_DBG_ID_REVISIONID_ADDR A:0x60500084
y.create.l HWIO_PCNOC_OBS_DBG_ATBID_ADDR A:0x60500088
y.create.l HWIO_PCNOC_OBS_DBG_ATBEN_ADDR A:0x6050008c
y.create.l HWIO_PCNOC_OBS_DBG_SYNCPERIOD_ADDR A:0x60500090
y.create.l HWIO_PCNOC_QXM_CRYPTO0_TFILT_ID_COREID_ADDR A:0x60501000
y.create.l HWIO_PCNOC_QXM_CRYPTO0_TFILT_ID_REVISIONID_ADDR A:0x60501004
y.create.l HWIO_PCNOC_QXM_CRYPTO0_TFILT_MODE_ADDR A:0x60501008
y.create.l HWIO_PCNOC_QXM_CRYPTO0_TFILT_ADDRBASE_LOW_ADDR A:0x6050100c
y.create.l HWIO_PCNOC_QXM_CRYPTO0_TFILT_ADDRBASE_HIGH_ADDR A:0x60501010
y.create.l HWIO_PCNOC_QXM_CRYPTO0_TFILT_ADDRWINDOWSIZE_ADDR A:0x60501014
y.create.l HWIO_PCNOC_QXM_CRYPTO0_TFILT_SRCIDBASE_ADDR A:0x60501018
y.create.l HWIO_PCNOC_QXM_CRYPTO0_TFILT_SRCIDMASK_ADDR A:0x6050101c
y.create.l HWIO_PCNOC_QXM_CRYPTO0_TFILT_OPCODE_ADDR A:0x60501020
y.create.l HWIO_PCNOC_QXM_CRYPTO0_TFILT_USERBASE_ADDR A:0x60501024
y.create.l HWIO_PCNOC_QXM_CRYPTO0_TFILT_USERMASK_ADDR A:0x60501028
y.create.l HWIO_PCNOC_QXM_SDC1_TFILT_ID_COREID_ADDR A:0x60501080
y.create.l HWIO_PCNOC_QXM_SDC1_TFILT_ID_REVISIONID_ADDR A:0x60501084
y.create.l HWIO_PCNOC_QXM_SDC1_TFILT_MODE_ADDR A:0x60501088
y.create.l HWIO_PCNOC_QXM_SDC1_TFILT_ADDRBASE_LOW_ADDR A:0x6050108c
y.create.l HWIO_PCNOC_QXM_SDC1_TFILT_ADDRBASE_HIGH_ADDR A:0x60501090
y.create.l HWIO_PCNOC_QXM_SDC1_TFILT_ADDRWINDOWSIZE_ADDR A:0x60501094
y.create.l HWIO_PCNOC_QXM_SDC1_TFILT_SRCIDBASE_ADDR A:0x60501098
y.create.l HWIO_PCNOC_QXM_SDC1_TFILT_SRCIDMASK_ADDR A:0x6050109c
y.create.l HWIO_PCNOC_QXM_SDC1_TFILT_OPCODE_ADDR A:0x605010a0
y.create.l HWIO_PCNOC_QXM_SDC1_TFILT_USERBASE_ADDR A:0x605010a4
y.create.l HWIO_PCNOC_QXM_SDC1_TFILT_USERMASK_ADDR A:0x605010a8
y.create.l HWIO_PCNOC_QXM_SDC2_TFILT_ID_COREID_ADDR A:0x60501100
y.create.l HWIO_PCNOC_QXM_SDC2_TFILT_ID_REVISIONID_ADDR A:0x60501104
y.create.l HWIO_PCNOC_QXM_SDC2_TFILT_MODE_ADDR A:0x60501108
y.create.l HWIO_PCNOC_QXM_SDC2_TFILT_ADDRBASE_LOW_ADDR A:0x6050110c
y.create.l HWIO_PCNOC_QXM_SDC2_TFILT_ADDRBASE_HIGH_ADDR A:0x60501110
y.create.l HWIO_PCNOC_QXM_SDC2_TFILT_ADDRWINDOWSIZE_ADDR A:0x60501114
y.create.l HWIO_PCNOC_QXM_SDC2_TFILT_SRCIDBASE_ADDR A:0x60501118
y.create.l HWIO_PCNOC_QXM_SDC2_TFILT_SRCIDMASK_ADDR A:0x6050111c
y.create.l HWIO_PCNOC_QXM_SDC2_TFILT_OPCODE_ADDR A:0x60501120
y.create.l HWIO_PCNOC_QXM_SDC2_TFILT_USERBASE_ADDR A:0x60501124
y.create.l HWIO_PCNOC_QXM_SDC2_TFILT_USERMASK_ADDR A:0x60501128
y.create.l HWIO_PCNOC_QHM2_TFILT_ID_COREID_ADDR A:0x60501180
y.create.l HWIO_PCNOC_QHM2_TFILT_ID_REVISIONID_ADDR A:0x60501184
y.create.l HWIO_PCNOC_QHM2_TFILT_MODE_ADDR A:0x60501188
y.create.l HWIO_PCNOC_QHM2_TFILT_ADDRBASE_LOW_ADDR A:0x6050118c
y.create.l HWIO_PCNOC_QHM2_TFILT_ADDRWINDOWSIZE_ADDR A:0x60501194
y.create.l HWIO_PCNOC_QHM2_TFILT_SRCIDBASE_ADDR A:0x60501198
y.create.l HWIO_PCNOC_QHM2_TFILT_SRCIDMASK_ADDR A:0x6050119c
y.create.l HWIO_PCNOC_QHM2_TFILT_OPCODE_ADDR A:0x605011a0
y.create.l HWIO_PCNOC_QHM2_TFILT_USERBASE_ADDR A:0x605011a4
y.create.l HWIO_PCNOC_QHM2_TFILT_USERMASK_ADDR A:0x605011a8
y.create.l HWIO_PCNOC_QHM1_TFILT_ID_COREID_ADDR A:0x60501200
y.create.l HWIO_PCNOC_QHM1_TFILT_ID_REVISIONID_ADDR A:0x60501204
y.create.l HWIO_PCNOC_QHM1_TFILT_MODE_ADDR A:0x60501208
y.create.l HWIO_PCNOC_QHM1_TFILT_ADDRBASE_LOW_ADDR A:0x6050120c
y.create.l HWIO_PCNOC_QHM1_TFILT_ADDRWINDOWSIZE_ADDR A:0x60501214
y.create.l HWIO_PCNOC_QHM1_TFILT_SRCIDBASE_ADDR A:0x60501218
y.create.l HWIO_PCNOC_QHM1_TFILT_SRCIDMASK_ADDR A:0x6050121c
y.create.l HWIO_PCNOC_QHM1_TFILT_OPCODE_ADDR A:0x60501220
y.create.l HWIO_PCNOC_QHM1_TFILT_USERBASE_ADDR A:0x60501224
y.create.l HWIO_PCNOC_QHM1_TFILT_USERMASK_ADDR A:0x60501228
y.create.l HWIO_PCNOC_QXM_SNOC_TFILT_ID_COREID_ADDR A:0x60501280
y.create.l HWIO_PCNOC_QXM_SNOC_TFILT_ID_REVISIONID_ADDR A:0x60501284
y.create.l HWIO_PCNOC_QXM_SNOC_TFILT_MODE_ADDR A:0x60501288
y.create.l HWIO_PCNOC_QXM_SNOC_TFILT_ADDRBASE_LOW_ADDR A:0x6050128c
y.create.l HWIO_PCNOC_QXM_SNOC_TFILT_ADDRBASE_HIGH_ADDR A:0x60501290
y.create.l HWIO_PCNOC_QXM_SNOC_TFILT_ADDRWINDOWSIZE_ADDR A:0x60501294
y.create.l HWIO_PCNOC_QXM_SNOC_TFILT_SRCIDBASE_ADDR A:0x60501298
y.create.l HWIO_PCNOC_QXM_SNOC_TFILT_SRCIDMASK_ADDR A:0x6050129c
y.create.l HWIO_PCNOC_QXM_SNOC_TFILT_OPCODE_ADDR A:0x605012a0
y.create.l HWIO_PCNOC_QXM_SNOC_TFILT_USERBASE_ADDR A:0x605012a4
y.create.l HWIO_PCNOC_QXM_SNOC_TFILT_USERMASK_ADDR A:0x605012a8
y.create.l HWIO_PCNOC_TPRB0_TPROF_ID_COREID_ADDR A:0x60502000
y.create.l HWIO_PCNOC_TPRB0_TPROF_ID_REVISIONID_ADDR A:0x60502004
y.create.l HWIO_PCNOC_TPRB0_TPROF_EN_ADDR A:0x60502008
y.create.l HWIO_PCNOC_TPRB0_TPROF_MODE_ADDR A:0x6050200c
y.create.l HWIO_PCNOC_TPRB0_TPROF_OBSERVEDSEL_0_ADDR A:0x60502010
y.create.l HWIO_PCNOC_TPRB0_TPROF_OBSERVEDSEL_1_ADDR A:0x60502014
y.create.l HWIO_PCNOC_TPRB0_TPROF_NTENURELINES_0_ADDR A:0x60502020
y.create.l HWIO_PCNOC_TPRB0_TPROF_THRESHOLDS_0_0_ADDR A:0x6050202c
y.create.l HWIO_PCNOC_TPRB0_TPROF_THRESHOLDS_0_1_ADDR A:0x60502030
y.create.l HWIO_PCNOC_TPRB0_TPROF_THRESHOLDS_0_2_ADDR A:0x60502034
y.create.l HWIO_PCNOC_TPRB0_TPROF_THRESHOLDS_1_0_ADDR A:0x6050203c
y.create.l HWIO_PCNOC_TPRB0_TPROF_THRESHOLDS_1_1_ADDR A:0x60502040
y.create.l HWIO_PCNOC_TPRB0_TPROF_THRESHOLDS_1_2_ADDR A:0x60502044
y.create.l HWIO_PCNOC_TPRB0_TPROF_OVERFLOWSTATUS_ADDR A:0x6050206c
y.create.l HWIO_PCNOC_TPRB0_TPROF_OVERFLOWRESET_ADDR A:0x60502070
y.create.l HWIO_PCNOC_TPRB0_TPROF_PENDINGEVENTMODE_ADDR A:0x60502074
y.create.l HWIO_PCNOC_TPRB0_TPROF_PRESCALER_ADDR A:0x60502078
y.create.l HWIO_PCNOC_EPRB0_SPROF_ID_COREID_ADDR A:0x60503000
y.create.l HWIO_PCNOC_EPRB0_SPROF_ID_REVISIONID_ADDR A:0x60503004
y.create.l HWIO_PCNOC_EPRB0_SPROF_MAINCTL_ADDR A:0x60503008
y.create.l HWIO_PCNOC_EPRB0_SPROF_CFGCTL_ADDR A:0x6050300c
y.create.l HWIO_PCNOC_EPRB0_SPROF_FILTERLUT_ADDR A:0x60503014
y.create.l HWIO_PCNOC_EPRB0_SPROF_TRACEALARMEN_ADDR A:0x60503018
y.create.l HWIO_PCNOC_EPRB0_SPROF_TRACEALARMSTATUS_ADDR A:0x6050301c
y.create.l HWIO_PCNOC_EPRB0_SPROF_TRACEALARMCLR_ADDR A:0x60503020
y.create.l HWIO_PCNOC_EPRB0_SPROF_STATPERIOD_ADDR A:0x60503024
y.create.l HWIO_PCNOC_EPRB0_SPROF_STATGO_ADDR A:0x60503028
y.create.l HWIO_PCNOC_EPRB0_SPROF_STATALARMMIN_ADDR A:0x6050302c
y.create.l HWIO_PCNOC_EPRB0_SPROF_STATALARMMAX_ADDR A:0x60503030
y.create.l HWIO_PCNOC_EPRB0_SPROF_STATALARMSTATUS_ADDR A:0x60503034
y.create.l HWIO_PCNOC_EPRB0_SPROF_STATALARMCLR_ADDR A:0x60503038
y.create.l HWIO_PCNOC_EPRB0_SPROF_STATALARMEN_ADDR A:0x6050303c
y.create.l HWIO_PCNOC_EPRB0_SPROF_FILTERS_0_ROUTEIDBASE_ADDR A:0x60503044
y.create.l HWIO_PCNOC_EPRB0_SPROF_FILTERS_0_ROUTEIDMASK_ADDR A:0x60503048
y.create.l HWIO_PCNOC_EPRB0_SPROF_FILTERS_0_ADDRBASE_LOW_ADDR A:0x6050304c
y.create.l HWIO_PCNOC_EPRB0_SPROF_FILTERS_0_ADDRBASE_HIGH_ADDR A:0x60503050
y.create.l HWIO_PCNOC_EPRB0_SPROF_FILTERS_0_WINDOWSIZE_ADDR A:0x60503054
y.create.l HWIO_PCNOC_EPRB0_SPROF_FILTERS_0_OPCODE_ADDR A:0x60503060
y.create.l HWIO_PCNOC_EPRB0_SPROF_FILTERS_0_STATUS_ADDR A:0x60503064
y.create.l HWIO_PCNOC_EPRB0_SPROF_FILTERS_0_LENGTH_ADDR A:0x60503068
y.create.l HWIO_PCNOC_EPRB0_SPROF_FILTERS_0_URGENCY_ADDR A:0x6050306c
y.create.l HWIO_PCNOC_EPRB0_SPROF_FILTERS_1_ROUTEIDBASE_ADDR A:0x60503080
y.create.l HWIO_PCNOC_EPRB0_SPROF_FILTERS_1_ROUTEIDMASK_ADDR A:0x60503084
y.create.l HWIO_PCNOC_EPRB0_SPROF_FILTERS_1_ADDRBASE_LOW_ADDR A:0x60503088
y.create.l HWIO_PCNOC_EPRB0_SPROF_FILTERS_1_ADDRBASE_HIGH_ADDR A:0x6050308c
y.create.l HWIO_PCNOC_EPRB0_SPROF_FILTERS_1_WINDOWSIZE_ADDR A:0x60503090
y.create.l HWIO_PCNOC_EPRB0_SPROF_FILTERS_1_OPCODE_ADDR A:0x6050309c
y.create.l HWIO_PCNOC_EPRB0_SPROF_FILTERS_1_STATUS_ADDR A:0x605030a0
y.create.l HWIO_PCNOC_EPRB0_SPROF_FILTERS_1_LENGTH_ADDR A:0x605030a4
y.create.l HWIO_PCNOC_EPRB0_SPROF_FILTERS_1_URGENCY_ADDR A:0x605030a8
y.create.l HWIO_PCNOC_EPRB0_SPROF_COUNTERS_0_SRC_ADDR A:0x60503138
y.create.l HWIO_PCNOC_EPRB0_SPROF_COUNTERS_0_ALARMMODE_ADDR A:0x6050313c
y.create.l HWIO_PCNOC_EPRB0_SPROF_COUNTERS_0_VAL_ADDR A:0x60503140
y.create.l HWIO_PCNOC_EPRB0_SPROF_COUNTERS_1_SRC_ADDR A:0x6050314c
y.create.l HWIO_PCNOC_EPRB0_SPROF_COUNTERS_1_ALARMMODE_ADDR A:0x60503150
y.create.l HWIO_PCNOC_EPRB0_SPROF_COUNTERS_1_VAL_ADDR A:0x60503154
y.create.l HWIO_PCNOC_EPRB0_SPROF_COUNTERS_2_SRC_ADDR A:0x60503160
y.create.l HWIO_PCNOC_EPRB0_SPROF_COUNTERS_2_ALARMMODE_ADDR A:0x60503164
y.create.l HWIO_PCNOC_EPRB0_SPROF_COUNTERS_2_VAL_ADDR A:0x60503168
y.create.l HWIO_PCNOC_EPRB0_SPROF_COUNTERS_3_SRC_ADDR A:0x60503174
y.create.l HWIO_PCNOC_EPRB0_SPROF_COUNTERS_3_ALARMMODE_ADDR A:0x60503178
y.create.l HWIO_PCNOC_EPRB0_SPROF_COUNTERS_3_VAL_ADDR A:0x6050317c
y.create.l HWIO_PCNOC_EPRB0_SPROF_COUNTERS_4_SRC_ADDR A:0x60503188
y.create.l HWIO_PCNOC_EPRB0_SPROF_COUNTERS_4_ALARMMODE_ADDR A:0x6050318c
y.create.l HWIO_PCNOC_EPRB0_SPROF_COUNTERS_4_VAL_ADDR A:0x60503190
y.create.l HWIO_PCNOC_EPRB0_SPROF_COUNTERS_5_SRC_ADDR A:0x6050319c
y.create.l HWIO_PCNOC_EPRB0_SPROF_COUNTERS_5_ALARMMODE_ADDR A:0x605031a0
y.create.l HWIO_PCNOC_EPRB0_SPROF_COUNTERS_5_VAL_ADDR A:0x605031a4
y.create.l HWIO_PCNOC_EPRB0_SPROF_COUNTERS_6_SRC_ADDR A:0x605031b0
y.create.l HWIO_PCNOC_EPRB0_SPROF_COUNTERS_6_ALARMMODE_ADDR A:0x605031b4
y.create.l HWIO_PCNOC_EPRB0_SPROF_COUNTERS_6_VAL_ADDR A:0x605031b8
y.create.l HWIO_PCNOC_EPRB0_SPROF_COUNTERS_7_SRC_ADDR A:0x605031c4
y.create.l HWIO_PCNOC_EPRB0_SPROF_COUNTERS_7_ALARMMODE_ADDR A:0x605031c8
y.create.l HWIO_PCNOC_EPRB0_SPROF_COUNTERS_7_VAL_ADDR A:0x605031cc
y.create.l HWIO_PCNOC_TPRB0_SPROF_ID_COREID_ADDR A:0x60504000
y.create.l HWIO_PCNOC_TPRB0_SPROF_ID_REVISIONID_ADDR A:0x60504004
y.create.l HWIO_PCNOC_TPRB0_SPROF_MAINCTL_ADDR A:0x60504008
y.create.l HWIO_PCNOC_TPRB0_SPROF_CFGCTL_ADDR A:0x6050400c
y.create.l HWIO_PCNOC_TPRB0_SPROF_STATPERIOD_ADDR A:0x60504024
y.create.l HWIO_PCNOC_TPRB0_SPROF_STATGO_ADDR A:0x60504028
y.create.l HWIO_PCNOC_TPRB0_SPROF_STATALARMMIN_ADDR A:0x6050402c
y.create.l HWIO_PCNOC_TPRB0_SPROF_STATALARMMAX_ADDR A:0x60504030
y.create.l HWIO_PCNOC_TPRB0_SPROF_STATALARMSTATUS_ADDR A:0x60504034
y.create.l HWIO_PCNOC_TPRB0_SPROF_STATALARMCLR_ADDR A:0x60504038
y.create.l HWIO_PCNOC_TPRB0_SPROF_STATALARMEN_ADDR A:0x6050403c
y.create.l HWIO_PCNOC_TPRB0_SPROF_COUNTERS_0_SRC_ADDR A:0x60504138
y.create.l HWIO_PCNOC_TPRB0_SPROF_COUNTERS_0_ALARMMODE_ADDR A:0x6050413c
y.create.l HWIO_PCNOC_TPRB0_SPROF_COUNTERS_0_VAL_ADDR A:0x60504140
y.create.l HWIO_PCNOC_TPRB0_SPROF_COUNTERS_1_SRC_ADDR A:0x6050414c
y.create.l HWIO_PCNOC_TPRB0_SPROF_COUNTERS_1_ALARMMODE_ADDR A:0x60504150
y.create.l HWIO_PCNOC_TPRB0_SPROF_COUNTERS_1_VAL_ADDR A:0x60504154
y.create.l HWIO_PCNOC_TPRB0_SPROF_COUNTERS_2_SRC_ADDR A:0x60504160
y.create.l HWIO_PCNOC_TPRB0_SPROF_COUNTERS_2_ALARMMODE_ADDR A:0x60504164
y.create.l HWIO_PCNOC_TPRB0_SPROF_COUNTERS_2_VAL_ADDR A:0x60504168
y.create.l HWIO_PCNOC_TPRB0_SPROF_COUNTERS_3_SRC_ADDR A:0x60504174
y.create.l HWIO_PCNOC_TPRB0_SPROF_COUNTERS_3_ALARMMODE_ADDR A:0x60504178
y.create.l HWIO_PCNOC_TPRB0_SPROF_COUNTERS_3_VAL_ADDR A:0x6050417c
y.create.l HWIO_PCNOC_TPRB0_SPROF_COUNTERS_4_SRC_ADDR A:0x60504188
y.create.l HWIO_PCNOC_TPRB0_SPROF_COUNTERS_4_ALARMMODE_ADDR A:0x6050418c
y.create.l HWIO_PCNOC_TPRB0_SPROF_COUNTERS_4_VAL_ADDR A:0x60504190
y.create.l HWIO_PCNOC_TPRB0_SPROF_COUNTERS_5_SRC_ADDR A:0x6050419c
y.create.l HWIO_PCNOC_TPRB0_SPROF_COUNTERS_5_ALARMMODE_ADDR A:0x605041a0
y.create.l HWIO_PCNOC_TPRB0_SPROF_COUNTERS_5_VAL_ADDR A:0x605041a4
y.create.l HWIO_PCNOC_TPRB0_SPROF_COUNTERS_6_SRC_ADDR A:0x605041b0
y.create.l HWIO_PCNOC_TPRB0_SPROF_COUNTERS_6_ALARMMODE_ADDR A:0x605041b4
y.create.l HWIO_PCNOC_TPRB0_SPROF_COUNTERS_6_VAL_ADDR A:0x605041b8
y.create.l HWIO_PCNOC_TPRB0_SPROF_COUNTERS_7_SRC_ADDR A:0x605041c4
y.create.l HWIO_PCNOC_TPRB0_SPROF_COUNTERS_7_ALARMMODE_ADDR A:0x605041c8
y.create.l HWIO_PCNOC_TPRB0_SPROF_COUNTERS_7_VAL_ADDR A:0x605041cc
y.create.l HWIO_PCNOC_TPRB0_SPROF_COUNTERS_8_SRC_ADDR A:0x605041d8
y.create.l HWIO_PCNOC_TPRB0_SPROF_COUNTERS_8_ALARMMODE_ADDR A:0x605041dc
y.create.l HWIO_PCNOC_TPRB0_SPROF_COUNTERS_8_VAL_ADDR A:0x605041e0
y.create.l HWIO_PCNOC_TPRB0_SPROF_COUNTERS_9_SRC_ADDR A:0x605041ec
y.create.l HWIO_PCNOC_TPRB0_SPROF_COUNTERS_9_ALARMMODE_ADDR A:0x605041f0
y.create.l HWIO_PCNOC_TPRB0_SPROF_COUNTERS_9_VAL_ADDR A:0x605041f4
y.create.l HWIO_PCNOC_TPRB0_SPROF_COUNTERS_10_SRC_ADDR A:0x60504200
y.create.l HWIO_PCNOC_TPRB0_SPROF_COUNTERS_10_ALARMMODE_ADDR A:0x60504204
y.create.l HWIO_PCNOC_TPRB0_SPROF_COUNTERS_10_VAL_ADDR A:0x60504208
y.create.l HWIO_PCNOC_TPRB0_SPROF_COUNTERS_11_SRC_ADDR A:0x60504214
y.create.l HWIO_PCNOC_TPRB0_SPROF_COUNTERS_11_ALARMMODE_ADDR A:0x60504218
y.create.l HWIO_PCNOC_TPRB0_SPROF_COUNTERS_11_VAL_ADDR A:0x6050421c
y.create.l HWIO_PCNOC_TPRB0_SPROF_COUNTERS_12_SRC_ADDR A:0x60504228
y.create.l HWIO_PCNOC_TPRB0_SPROF_COUNTERS_12_ALARMMODE_ADDR A:0x6050422c
y.create.l HWIO_PCNOC_TPRB0_SPROF_COUNTERS_12_VAL_ADDR A:0x60504230
y.create.l HWIO_PCNOC_TPRB0_SPROF_COUNTERS_13_SRC_ADDR A:0x6050423c
y.create.l HWIO_PCNOC_TPRB0_SPROF_COUNTERS_13_ALARMMODE_ADDR A:0x60504240
y.create.l HWIO_PCNOC_TPRB0_SPROF_COUNTERS_13_VAL_ADDR A:0x60504244
y.create.l HWIO_PCNOC_TPRB0_SPROF_COUNTERS_14_SRC_ADDR A:0x60504250
y.create.l HWIO_PCNOC_TPRB0_SPROF_COUNTERS_14_ALARMMODE_ADDR A:0x60504254
y.create.l HWIO_PCNOC_TPRB0_SPROF_COUNTERS_14_VAL_ADDR A:0x60504258
y.create.l HWIO_PCNOC_TPRB0_SPROF_COUNTERS_15_SRC_ADDR A:0x60504264
y.create.l HWIO_PCNOC_TPRB0_SPROF_COUNTERS_15_ALARMMODE_ADDR A:0x60504268
y.create.l HWIO_PCNOC_TPRB0_SPROF_COUNTERS_15_VAL_ADDR A:0x6050426c
y.create.l HWIO_PCNOC_CRYPTO0_QOS_ID_COREID_ADDR A:0x60507000
y.create.l HWIO_PCNOC_CRYPTO0_QOS_ID_REVISIONID_ADDR A:0x60507004
y.create.l HWIO_PCNOC_CRYPTO0_QOS_PRIORITY_ADDR A:0x60507008
y.create.l HWIO_PCNOC_CRYPTO0_QOS_MODE_ADDR A:0x6050700c
y.create.l HWIO_PCNOC_CRYPTO0_QOS_EXTCONTROL_ADDR A:0x60507018
y.create.l HWIO_PCNOC_QHM1_QOS_ID_COREID_ADDR A:0x6050c000
y.create.l HWIO_PCNOC_QHM1_QOS_ID_REVISIONID_ADDR A:0x6050c004
y.create.l HWIO_PCNOC_QHM1_QOS_PRIORITY_ADDR A:0x6050c008
y.create.l HWIO_PCNOC_QHM1_QOS_MODE_ADDR A:0x6050c00c
y.create.l HWIO_PCNOC_QHM1_QOS_EXTCONTROL_ADDR A:0x6050c018
y.create.l HWIO_PCNOC_QHM2_QOS_ID_COREID_ADDR A:0x6050d000
y.create.l HWIO_PCNOC_QHM2_QOS_ID_REVISIONID_ADDR A:0x6050d004
y.create.l HWIO_PCNOC_QHM2_QOS_PRIORITY_ADDR A:0x6050d008
y.create.l HWIO_PCNOC_QHM2_QOS_MODE_ADDR A:0x6050d00c
y.create.l HWIO_PCNOC_QHM2_QOS_EXTCONTROL_ADDR A:0x6050d018
y.create.l HWIO_PCNOC_SDC1_QOS_ID_COREID_ADDR A:0x6050e000
y.create.l HWIO_PCNOC_SDC1_QOS_ID_REVISIONID_ADDR A:0x6050e004
y.create.l HWIO_PCNOC_SDC1_QOS_PRIORITY_ADDR A:0x6050e008
y.create.l HWIO_PCNOC_SDC1_QOS_MODE_ADDR A:0x6050e00c
y.create.l HWIO_PCNOC_SDC1_QOS_EXTCONTROL_ADDR A:0x6050e018
y.create.l HWIO_PCNOC_SDC2_QOS_ID_COREID_ADDR A:0x6050f000
y.create.l HWIO_PCNOC_SDC2_QOS_ID_REVISIONID_ADDR A:0x6050f004
y.create.l HWIO_PCNOC_SDC2_QOS_PRIORITY_ADDR A:0x6050f008
y.create.l HWIO_PCNOC_SDC2_QOS_MODE_ADDR A:0x6050f00c
y.create.l HWIO_PCNOC_SDC2_QOS_EXTCONTROL_ADDR A:0x6050f018
y.create.l HWIO_PCNOC_SNOC_QOS_ID_COREID_ADDR A:0x60510000
y.create.l HWIO_PCNOC_SNOC_QOS_ID_REVISIONID_ADDR A:0x60510004
y.create.l HWIO_PCNOC_SNOC_QOS_PRIORITY_ADDR A:0x60510008
y.create.l HWIO_PCNOC_SNOC_QOS_MODE_ADDR A:0x6051000c
y.create.l HWIO_PCNOC_SNOC_QOS_EXTCONTROL_ADDR A:0x60510018
y.create.l HWIO_PDM_TCXO_PDM0_TOP_CTL_ADDR A:0x60068000
y.create.l HWIO_PDM_PDM0_CTL_ADDR A:0x60068004
y.create.l HWIO_PDM_WEB_TCXO4_TEST_ADDR A:0x60068008
y.create.l HWIO_PDM_TCXO_PDM1_TOP_CTL_ADDR A:0x60069000
y.create.l HWIO_PDM_PDM1_CTL_ADDR A:0x60069004
y.create.l HWIO_PDM_TCXO_PDM2_TOP_CTL_ADDR A:0x6006a000
y.create.l HWIO_PDM_PDM2_CTL_ADDR A:0x6006a004
y.create.l HWIO_PDM_GP_MN_CLK_MDIV_ADDR A:0x6006b000
y.create.l HWIO_PDM_GP_MN_CLK_NDIV_ADDR A:0x6006b004
y.create.l HWIO_PDM_GP_MN_CLK_DUTY_ADDR A:0x6006b008
y.create.l HWIO_SPMI_GENI_CLK_CTRL_ADDR A:0x6200a000
y.create.l HWIO_SPMI_GENI_HW_VERSION_ADDR A:0x6200a004
y.create.l HWIO_SPMI_GENI_FW_REVISION_ADDR A:0x6200a008
y.create.l HWIO_SPMI_GENI_S_FW_REVISION_ADDR A:0x6200a00c
y.create.l HWIO_SPMI_GENI_FORCE_DEFAULT_REG_ADDR A:0x6200a010
y.create.l HWIO_SPMI_GENI_OUTPUT_CTRL_ADDR A:0x6200a014
y.create.l HWIO_SPMI_GENI_CGC_CTRL_ADDR A:0x6200a018
y.create.l HWIO_SPMI_GENI_CHAR_CFG_ADDR A:0x6200a01c
y.create.l HWIO_SPMI_GENI_CHAR_DATA_0_ADDR A:0x6200a020
y.create.l HWIO_SPMI_GENI_CHAR_DATA_1_ADDR A:0x6200a024
y.create.l HWIO_SPMI_GENI_CTRL_ADDR A:0x6200a028
y.create.l HWIO_SPMI_GENI_STATUS_ADDR A:0x6200a02c
y.create.l HWIO_SPMI_GENI_TEST_BUS_CTRL_ADDR A:0x6200a030
y.create.l HWIO_SPMI_GENI_SER_CLK_CFG_ADDR A:0x6200a034
y.create.l HWIO_SPMI_GENI_TX_WATERMARK_REG_ADDR A:0x6200a038
y.create.l HWIO_SPMI_GENI_RX_WATERMARK_REG_ADDR A:0x6200a03c
y.create.l HWIO_SPMI_GENI_STOP_REG_ADDR A:0x6200a040
y.create.l HWIO_SPMI_GENI_SW_COMP_REG_ADDR A:0x6200a044
y.create.l HWIO_SPMI_GENI_PROG_ROM_CTRL_REG_ADDR A:0x6200a048
y.create.l HWIO_SPMI_GENI_CFG_REG0_ADDR A:0x6200a100
y.create.l HWIO_SPMI_GENI_CFG_REG1_ADDR A:0x6200a104
y.create.l HWIO_SPMI_GENI_CFG_REG2_ADDR A:0x6200a108
y.create.l HWIO_SPMI_GENI_CFG_REG3_ADDR A:0x6200a10c
y.create.l HWIO_SPMI_GENI_CFG_REG4_ADDR A:0x6200a110
y.create.l HWIO_SPMI_GENI_CFG_REG5_ADDR A:0x6200a114
y.create.l HWIO_SPMI_GENI_CFG_REG6_ADDR A:0x6200a118
y.create.l HWIO_SPMI_GENI_CFG_REG7_ADDR A:0x6200a11c
y.create.l HWIO_SPMI_GENI_CFG_REG8_ADDR A:0x6200a120
y.create.l HWIO_SPMI_GENI_CFG_REG9_ADDR A:0x6200a124
y.create.l HWIO_SPMI_GENI_CFG_REG10_ADDR A:0x6200a128
y.create.l HWIO_SPMI_GENI_CFG_REG11_ADDR A:0x6200a12c
y.create.l HWIO_SPMI_GENI_CFG_REG12_ADDR A:0x6200a130
y.create.l HWIO_SPMI_GENI_CFG_REG13_ADDR A:0x6200a134
y.create.l HWIO_SPMI_GENI_CFG_REG14_ADDR A:0x6200a138
y.create.l HWIO_SPMI_GENI_CFG_REG15_ADDR A:0x6200a13c
y.create.l HWIO_SPMI_GENI_CFG_REG16_ADDR A:0x6200a140
y.create.l HWIO_SPMI_GENI_CFG_REG17_ADDR A:0x6200a144
y.create.l HWIO_SPMI_GENI_CFG_REG18_ADDR A:0x6200a148
y.create.l HWIO_SPMI_GENI_CFG_REG19_ADDR A:0x6200a14c
y.create.l HWIO_SPMI_GENI_CFG_REG20_ADDR A:0x6200a150
y.create.l HWIO_SPMI_GENI_CFG_REG21_ADDR A:0x6200a154
y.create.l HWIO_SPMI_GENI_CFG_REG22_ADDR A:0x6200a158
y.create.l HWIO_SPMI_GENI_CFG_REG23_ADDR A:0x6200a15c
y.create.l HWIO_SPMI_GENI_CFG_REG24_ADDR A:0x6200a160
y.create.l HWIO_SPMI_GENI_CFG_REG25_ADDR A:0x6200a164
y.create.l HWIO_SPMI_GENI_CFG_REG26_ADDR A:0x6200a168
y.create.l HWIO_SPMI_GENI_CFG_REG27_ADDR A:0x6200a16c
y.create.l HWIO_SPMI_GENI_CFG_REG28_ADDR A:0x6200a170
y.create.l HWIO_SPMI_GENI_CFG_REG29_ADDR A:0x6200a174
y.create.l HWIO_SPMI_GENI_CFG_REG30_ADDR A:0x6200a178
y.create.l HWIO_SPMI_GENI_CFG_RAM0_ADDR A:0x6200a200
y.create.l HWIO_SPMI_GENI_CFG_RAM1_ADDR A:0x6200a204
y.create.l HWIO_SPMI_GENI_CFG_RAM2_ADDR A:0x6200a208
y.create.l HWIO_SPMI_GENI_CFG_RAM3_ADDR A:0x6200a20c
y.create.l HWIO_SPMI_GENI_CFG_RAM4_ADDR A:0x6200a210
y.create.l HWIO_SPMI_GENI_CFG_RAM5_ADDR A:0x6200a214
y.create.l HWIO_SPMI_GENI_CFG_RAM6_ADDR A:0x6200a218
y.create.l HWIO_SPMI_GENI_CFG_RAM7_ADDR A:0x6200a21c
y.create.l HWIO_SPMI_GENI_CFG_RAM8_ADDR A:0x6200a220
y.create.l HWIO_SPMI_GENI_CFG_RAM9_ADDR A:0x6200a224
y.create.l HWIO_SPMI_PERIPH0_2OWNER_TABLE_REG_ADDR A:0x6200a700
y.create.l HWIO_SPMI_PERIPH1_2OWNER_TABLE_REG_ADDR A:0x6200a704
y.create.l HWIO_SPMI_PERIPH2_2OWNER_TABLE_REG_ADDR A:0x6200a708
y.create.l HWIO_SPMI_PERIPH3_2OWNER_TABLE_REG_ADDR A:0x6200a70c
y.create.l HWIO_SPMI_PERIPH4_2OWNER_TABLE_REG_ADDR A:0x6200a710
y.create.l HWIO_SPMI_PERIPH5_2OWNER_TABLE_REG_ADDR A:0x6200a714
y.create.l HWIO_SPMI_PERIPH6_2OWNER_TABLE_REG_ADDR A:0x6200a718
y.create.l HWIO_SPMI_PERIPH7_2OWNER_TABLE_REG_ADDR A:0x6200a71c
y.create.l HWIO_SPMI_PERIPH8_2OWNER_TABLE_REG_ADDR A:0x6200a720
y.create.l HWIO_SPMI_PERIPH9_2OWNER_TABLE_REG_ADDR A:0x6200a724
y.create.l HWIO_SPMI_MAPPING_TABLE_REG0_ADDR A:0x6200ab00
y.create.l HWIO_SPMI_MAPPING_TABLE_REG1_ADDR A:0x6200ab04
y.create.l HWIO_SPMI_MAPPING_TABLE_REG2_ADDR A:0x6200ab08
y.create.l HWIO_SPMI_MAPPING_TABLE_REG3_ADDR A:0x6200ab0c
y.create.l HWIO_SPMI_MAPPING_TABLE_REG4_ADDR A:0x6200ab10
y.create.l HWIO_SPMI_MAPPING_TABLE_REG5_ADDR A:0x6200ab14
y.create.l HWIO_SPMI_MAPPING_TABLE_REG6_ADDR A:0x6200ab18
y.create.l HWIO_SPMI_MAPPING_TABLE_REG7_ADDR A:0x6200ab1c
y.create.l HWIO_SPMI_MAPPING_TABLE_REG8_ADDR A:0x6200ab20
y.create.l HWIO_SPMI_MAPPING_TABLE_REG9_ADDR A:0x6200ab24
y.create.l HWIO_SPMI_MID_REG_ADDR A:0x6200af00
y.create.l HWIO_SPMI_CFG_REG_ADDR A:0x6200af04
y.create.l HWIO_SPMI_SEC_DISABLE_REG_ADDR A:0x6200af08
y.create.l HWIO_SPMI_HW_VERSION_ADDR A:0x6200af0c
y.create.l HWIO_SPMI_CGC_CTRL_ADDR A:0x6200af10
y.create.l HWIO_SPMI_MWB_ENABLE_REG_ADDR A:0x6200af14
y.create.l HWIO_SPMI_CHAR_CFG_ADDR A:0x6200af40
y.create.l HWIO_SPMI_CHAR_DATA_0_ADDR A:0x6200af44
y.create.l HWIO_SPMI_CHAR_DATA_1_ADDR A:0x6200af48
y.create.l HWIO_SPMI_CMPR_EN_REG_ADDR A:0x6200af54
y.create.l HWIO_SPMI_PROTOCOL_IRQ_STATUS_ADDR A:0x6200b000
y.create.l HWIO_SPMI_PROTOCOL_IRQ_ENABLE_ADDR A:0x6200b004
y.create.l HWIO_SPMI_PROTOCOL_IRQ_CLEAR_ADDR A:0x6200b008
y.create.l HWIO_SPMI_PROTOCOL_IRQ_EN_SET_ADDR A:0x6200b00c
y.create.l HWIO_SPMI_PROTOCOL_IRQ_EN_CLEAR_ADDR A:0x6200b010
y.create.l HWIO_SPMI_TEST_BUS_CTRL_ADDR A:0x6200c000
y.create.l HWIO_SPMI_HW_SW_EVENTS_CTRL_ADDR A:0x6200c004
y.create.l HWIO_SPMI_HW_SW_EVENTS_BITWISE_REG0_ADDR A:0x6200c008
y.create.l HWIO_SPMI_HW_SW_EVENTS_BITWISE_REG1_ADDR A:0x6200c00c
y.create.l HWIO_SPMI_HW_SW_EVENTS_BITWISE_REG2_ADDR A:0x6200c010
y.create.l HWIO_SPMI_HW_SW_EVENTS_BITWISE_REG3_ADDR A:0x6200c014
y.create.l HWIO_SPMI_HW_SW_EVENTS_BITWISE_REG4_ADDR A:0x6200c018
y.create.l HWIO_SPMI_HW_SW_EVENTS_BITWISE_REG5_ADDR A:0x6200c01c
y.create.l HWIO_SPMI_HW_SW_EVENTS_BITWISE_REG6_ADDR A:0x6200c020
y.create.l HWIO_SPMI_HW_SW_EVENTS_BITWISE_REG7_ADDR A:0x6200c024
y.create.l HWIO_SPMI_PIC_OWNER0_ACC_STATUS0_ADDR A:0x63900000
y.create.l HWIO_SPMI_PIC_OWNER0_ACC_STATUS1_ADDR A:0x63900004
y.create.l HWIO_SPMI_PIC_OWNER0_ACC_STATUS2_ADDR A:0x63900008
y.create.l HWIO_SPMI_PIC_OWNER0_ACC_STATUS3_ADDR A:0x6390000c
y.create.l HWIO_SPMI_PIC_OWNER1_ACC_STATUS0_ADDR A:0x63901000
y.create.l HWIO_SPMI_PIC_OWNER1_ACC_STATUS1_ADDR A:0x63901004
y.create.l HWIO_SPMI_PIC_OWNER1_ACC_STATUS2_ADDR A:0x63901008
y.create.l HWIO_SPMI_PIC_OWNER1_ACC_STATUS3_ADDR A:0x6390100c
y.create.l HWIO_SPMI_PIC_OWNER2_ACC_STATUS0_ADDR A:0x63902000
y.create.l HWIO_SPMI_PIC_OWNER2_ACC_STATUS1_ADDR A:0x63902004
y.create.l HWIO_SPMI_PIC_OWNER2_ACC_STATUS2_ADDR A:0x63902008
y.create.l HWIO_SPMI_PIC_OWNER2_ACC_STATUS3_ADDR A:0x6390200c
y.create.l HWIO_SPMI_PIC_OWNER3_ACC_STATUS0_ADDR A:0x63903000
y.create.l HWIO_SPMI_PIC_OWNER3_ACC_STATUS1_ADDR A:0x63903004
y.create.l HWIO_SPMI_PIC_OWNER3_ACC_STATUS2_ADDR A:0x63903008
y.create.l HWIO_SPMI_PIC_OWNER3_ACC_STATUS3_ADDR A:0x6390300c
y.create.l HWIO_SPMI_PIC_OWNER4_ACC_STATUS0_ADDR A:0x63904000
y.create.l HWIO_SPMI_PIC_OWNER4_ACC_STATUS1_ADDR A:0x63904004
y.create.l HWIO_SPMI_PIC_OWNER4_ACC_STATUS2_ADDR A:0x63904008
y.create.l HWIO_SPMI_PIC_OWNER4_ACC_STATUS3_ADDR A:0x6390400c
y.create.l HWIO_SPMI_PIC_OWNER5_ACC_STATUS0_ADDR A:0x63905000
y.create.l HWIO_SPMI_PIC_OWNER5_ACC_STATUS1_ADDR A:0x63905004
y.create.l HWIO_SPMI_PIC_OWNER5_ACC_STATUS2_ADDR A:0x63905008
y.create.l HWIO_SPMI_PIC_OWNER5_ACC_STATUS3_ADDR A:0x6390500c
y.create.l HWIO_SPMI_PIC_ACC_ENABLE0_ADDR A:0x63800000
y.create.l HWIO_SPMI_PIC_ACC_ENABLE1_ADDR A:0x63801000
y.create.l HWIO_SPMI_PIC_ACC_ENABLE2_ADDR A:0x63802000
y.create.l HWIO_SPMI_PIC_ACC_ENABLE3_ADDR A:0x63803000
y.create.l HWIO_SPMI_PIC_ACC_ENABLE4_ADDR A:0x63804000
y.create.l HWIO_SPMI_PIC_ACC_ENABLE5_ADDR A:0x63805000
y.create.l HWIO_SPMI_PIC_ACC_ENABLE6_ADDR A:0x63806000
y.create.l HWIO_SPMI_PIC_ACC_ENABLE7_ADDR A:0x63807000
y.create.l HWIO_SPMI_PIC_ACC_ENABLE8_ADDR A:0x63808000
y.create.l HWIO_SPMI_PIC_ACC_ENABLE9_ADDR A:0x63809000
y.create.l HWIO_SPMI_PIC_IRQ_STATUS0_ADDR A:0x63800004
y.create.l HWIO_SPMI_PIC_IRQ_STATUS1_ADDR A:0x63801004
y.create.l HWIO_SPMI_PIC_IRQ_STATUS2_ADDR A:0x63802004
y.create.l HWIO_SPMI_PIC_IRQ_STATUS3_ADDR A:0x63803004
y.create.l HWIO_SPMI_PIC_IRQ_STATUS4_ADDR A:0x63804004
y.create.l HWIO_SPMI_PIC_IRQ_STATUS5_ADDR A:0x63805004
y.create.l HWIO_SPMI_PIC_IRQ_STATUS6_ADDR A:0x63806004
y.create.l HWIO_SPMI_PIC_IRQ_STATUS7_ADDR A:0x63807004
y.create.l HWIO_SPMI_PIC_IRQ_STATUS8_ADDR A:0x63808004
y.create.l HWIO_SPMI_PIC_IRQ_STATUS9_ADDR A:0x63809004
y.create.l HWIO_SPMI_PIC_IRQ_CLEAR0_ADDR A:0x63800008
y.create.l HWIO_SPMI_PIC_IRQ_CLEAR1_ADDR A:0x63801008
y.create.l HWIO_SPMI_PIC_IRQ_CLEAR2_ADDR A:0x63802008
y.create.l HWIO_SPMI_PIC_IRQ_CLEAR3_ADDR A:0x63803008
y.create.l HWIO_SPMI_PIC_IRQ_CLEAR4_ADDR A:0x63804008
y.create.l HWIO_SPMI_PIC_IRQ_CLEAR5_ADDR A:0x63805008
y.create.l HWIO_SPMI_PIC_IRQ_CLEAR6_ADDR A:0x63806008
y.create.l HWIO_SPMI_PIC_IRQ_CLEAR7_ADDR A:0x63807008
y.create.l HWIO_SPMI_PIC_IRQ_CLEAR8_ADDR A:0x63808008
y.create.l HWIO_SPMI_PIC_IRQ_CLEAR9_ADDR A:0x63809008
y.create.l HWIO_PMIC_ARB_XPU_SCR_ADDR A:0x6200e000
y.create.l HWIO_PMIC_ARB_XPU_SWDR_ADDR A:0x6200e004
y.create.l HWIO_PMIC_ARB_XPU_PRTN_RACR_SSHADOW_ADDR A:0x6200e008
y.create.l HWIO_PMIC_ARB_XPU_PRTN_WACR_SSHADOW_ADDR A:0x6200e00c
y.create.l HWIO_PMIC_ARB_XPU_PRTN_START_SSHADOW0_ADDR A:0x6200e010
y.create.l HWIO_PMIC_ARB_XPU_PRTN_END_SSHADOW0_ADDR A:0x6200e018
y.create.l HWIO_PMIC_ARB_XPU_SEAR0_ADDR A:0x6200e040
y.create.l HWIO_PMIC_ARB_XPU_SESR_ADDR A:0x6200e048
y.create.l HWIO_PMIC_ARB_XPU_SESRRESTORE_ADDR A:0x6200e04c
y.create.l HWIO_PMIC_ARB_XPU_SESYNR0_ADDR A:0x6200e050
y.create.l HWIO_PMIC_ARB_XPU_SESYNR1_ADDR A:0x6200e054
y.create.l HWIO_PMIC_ARB_XPU_SESYNR2_ADDR A:0x6200e058
y.create.l HWIO_PMIC_ARB_XPU_MCR_ADDR A:0x6200e100
y.create.l HWIO_PMIC_ARB_XPU_MEAR0_ADDR A:0x6200e140
y.create.l HWIO_PMIC_ARB_XPU_MESR_ADDR A:0x6200e148
y.create.l HWIO_PMIC_ARB_XPU_MESRRESTORE_ADDR A:0x6200e14c
y.create.l HWIO_PMIC_ARB_XPU_MESYNR0_ADDR A:0x6200e150
y.create.l HWIO_PMIC_ARB_XPU_MESYNR1_ADDR A:0x6200e154
y.create.l HWIO_PMIC_ARB_XPU_MESYNR2_ADDR A:0x6200e158
y.create.l HWIO_PMIC_ARB_XPU_CR_ADDR A:0x6200e080
y.create.l HWIO_PMIC_ARB_XPU_PRTN_RACR_SHADOW_ADDR A:0x6200e088
y.create.l HWIO_PMIC_ARB_XPU_PRTN_WACR_SHADOW_ADDR A:0x6200e08c
y.create.l HWIO_PMIC_ARB_XPU_PRTN_START_SHADOW0_ADDR A:0x6200e090
y.create.l HWIO_PMIC_ARB_XPU_PRTN_END_SHADOW0_ADDR A:0x6200e098
y.create.l HWIO_PMIC_ARB_XPU_RPU_ACR0_ADDR A:0x6200e0a0
y.create.l HWIO_PMIC_ARB_XPU_EAR0_ADDR A:0x6200e0c0
y.create.l HWIO_PMIC_ARB_XPU_ESR_ADDR A:0x6200e0c8
y.create.l HWIO_PMIC_ARB_XPU_ESRRESTORE_ADDR A:0x6200e0cc
y.create.l HWIO_PMIC_ARB_XPU_ESYNR0_ADDR A:0x6200e0d0
y.create.l HWIO_PMIC_ARB_XPU_ESYNR1_ADDR A:0x6200e0d4
y.create.l HWIO_PMIC_ARB_XPU_ESYNR2_ADDR A:0x6200e0d8
y.create.l HWIO_PMIC_ARB_XPU_UMR_RACR_ADDR A:0x6200e0e0
y.create.l HWIO_PMIC_ARB_XPU_UMR_WACR_ADDR A:0x6200e0e4
y.create.l HWIO_PMIC_ARB_XPU_UMR_CNTL_ADDR A:0x6200e0f0
y.create.l HWIO_PMIC_ARB_XPU_IDR0_ADDR A:0x6200e074
y.create.l HWIO_PMIC_ARB_XPU_IDR1_ADDR A:0x6200e078
y.create.l HWIO_PMIC_ARB_XPU_REV_ADDR A:0x6200e07c
y.create.l HWIO_PMIC_ARB_XPU_PRT0_RACR0_ADDR A:0x6200e200
y.create.l HWIO_PMIC_ARB_XPU_PRT1_RACR0_ADDR A:0x6200e280
y.create.l HWIO_PMIC_ARB_XPU_PRT2_RACR0_ADDR A:0x6200e300
y.create.l HWIO_PMIC_ARB_XPU_PRT3_RACR0_ADDR A:0x6200e380
y.create.l HWIO_PMIC_ARB_XPU_PRT4_RACR0_ADDR A:0x6200e400
y.create.l HWIO_PMIC_ARB_XPU_PRT5_RACR0_ADDR A:0x6200e480
y.create.l HWIO_PMIC_ARB_XPU_PRT6_RACR0_ADDR A:0x6200e500
y.create.l HWIO_PMIC_ARB_XPU_PRT7_RACR0_ADDR A:0x6200e580
y.create.l HWIO_PMIC_ARB_XPU_PRT8_RACR0_ADDR A:0x6200e600
y.create.l HWIO_PMIC_ARB_XPU_PRT9_RACR0_ADDR A:0x6200e680
y.create.l HWIO_PMIC_ARB_XPU_PRT0_WACR0_ADDR A:0x6200e220
y.create.l HWIO_PMIC_ARB_XPU_PRT1_WACR0_ADDR A:0x6200e2a0
y.create.l HWIO_PMIC_ARB_XPU_PRT2_WACR0_ADDR A:0x6200e320
y.create.l HWIO_PMIC_ARB_XPU_PRT3_WACR0_ADDR A:0x6200e3a0
y.create.l HWIO_PMIC_ARB_XPU_PRT4_WACR0_ADDR A:0x6200e420
y.create.l HWIO_PMIC_ARB_XPU_PRT5_WACR0_ADDR A:0x6200e4a0
y.create.l HWIO_PMIC_ARB_XPU_PRT6_WACR0_ADDR A:0x6200e520
y.create.l HWIO_PMIC_ARB_XPU_PRT7_WACR0_ADDR A:0x6200e5a0
y.create.l HWIO_PMIC_ARB_XPU_PRT8_WACR0_ADDR A:0x6200e620
y.create.l HWIO_PMIC_ARB_XPU_PRT9_WACR0_ADDR A:0x6200e6a0
y.create.l HWIO_PMIC_ARB_XPU_PRT0_START0_ADDR A:0x6200e240
y.create.l HWIO_PMIC_ARB_XPU_PRT1_START0_ADDR A:0x6200e2c0
y.create.l HWIO_PMIC_ARB_XPU_PRT2_START0_ADDR A:0x6200e340
y.create.l HWIO_PMIC_ARB_XPU_PRT3_START0_ADDR A:0x6200e3c0
y.create.l HWIO_PMIC_ARB_XPU_PRT4_START0_ADDR A:0x6200e440
y.create.l HWIO_PMIC_ARB_XPU_PRT5_START0_ADDR A:0x6200e4c0
y.create.l HWIO_PMIC_ARB_XPU_PRT6_START0_ADDR A:0x6200e540
y.create.l HWIO_PMIC_ARB_XPU_PRT7_START0_ADDR A:0x6200e5c0
y.create.l HWIO_PMIC_ARB_XPU_PRT8_START0_ADDR A:0x6200e640
y.create.l HWIO_PMIC_ARB_XPU_PRT9_START0_ADDR A:0x6200e6c0
y.create.l HWIO_PMIC_ARB_XPU_PRT0_END0_ADDR A:0x6200e248
y.create.l HWIO_PMIC_ARB_XPU_PRT1_END0_ADDR A:0x6200e2c8
y.create.l HWIO_PMIC_ARB_XPU_PRT2_END0_ADDR A:0x6200e348
y.create.l HWIO_PMIC_ARB_XPU_PRT3_END0_ADDR A:0x6200e3c8
y.create.l HWIO_PMIC_ARB_XPU_PRT4_END0_ADDR A:0x6200e448
y.create.l HWIO_PMIC_ARB_XPU_PRT5_END0_ADDR A:0x6200e4c8
y.create.l HWIO_PMIC_ARB_XPU_PRT6_END0_ADDR A:0x6200e548
y.create.l HWIO_PMIC_ARB_XPU_PRT7_END0_ADDR A:0x6200e5c8
y.create.l HWIO_PMIC_ARB_XPU_PRT8_END0_ADDR A:0x6200e648
y.create.l HWIO_PMIC_ARB_XPU_PRT9_END0_ADDR A:0x6200e6c8
y.create.l HWIO_PMIC_ARB_XPU_PRT0_SCR_ADDR A:0x6200e250
y.create.l HWIO_PMIC_ARB_XPU_PRT1_SCR_ADDR A:0x6200e2d0
y.create.l HWIO_PMIC_ARB_XPU_PRT2_SCR_ADDR A:0x6200e350
y.create.l HWIO_PMIC_ARB_XPU_PRT3_SCR_ADDR A:0x6200e3d0
y.create.l HWIO_PMIC_ARB_XPU_PRT4_SCR_ADDR A:0x6200e450
y.create.l HWIO_PMIC_ARB_XPU_PRT5_SCR_ADDR A:0x6200e4d0
y.create.l HWIO_PMIC_ARB_XPU_PRT6_SCR_ADDR A:0x6200e550
y.create.l HWIO_PMIC_ARB_XPU_PRT7_SCR_ADDR A:0x6200e5d0
y.create.l HWIO_PMIC_ARB_XPU_PRT8_SCR_ADDR A:0x6200e650
y.create.l HWIO_PMIC_ARB_XPU_PRT9_SCR_ADDR A:0x6200e6d0
y.create.l HWIO_PMIC_ARB_XPU_PRT0_MCR_ADDR A:0x6200e254
y.create.l HWIO_PMIC_ARB_XPU_PRT1_MCR_ADDR A:0x6200e2d4
y.create.l HWIO_PMIC_ARB_XPU_PRT2_MCR_ADDR A:0x6200e354
y.create.l HWIO_PMIC_ARB_XPU_PRT3_MCR_ADDR A:0x6200e3d4
y.create.l HWIO_PMIC_ARB_XPU_PRT4_MCR_ADDR A:0x6200e454
y.create.l HWIO_PMIC_ARB_XPU_PRT5_MCR_ADDR A:0x6200e4d4
y.create.l HWIO_PMIC_ARB_XPU_PRT6_MCR_ADDR A:0x6200e554
y.create.l HWIO_PMIC_ARB_XPU_PRT7_MCR_ADDR A:0x6200e5d4
y.create.l HWIO_PMIC_ARB_XPU_PRT8_MCR_ADDR A:0x6200e654
y.create.l HWIO_PMIC_ARB_XPU_PRT9_MCR_ADDR A:0x6200e6d4
y.create.l HWIO_PMIC_ARB_XPU_PRT0_CNTL0_ADDR A:0x6200e258
y.create.l HWIO_PMIC_ARB_XPU_PRT1_CNTL0_ADDR A:0x6200e2d8
y.create.l HWIO_PMIC_ARB_XPU_PRT2_CNTL0_ADDR A:0x6200e358
y.create.l HWIO_PMIC_ARB_XPU_PRT3_CNTL0_ADDR A:0x6200e3d8
y.create.l HWIO_PMIC_ARB_XPU_PRT4_CNTL0_ADDR A:0x6200e458
y.create.l HWIO_PMIC_ARB_XPU_PRT5_CNTL0_ADDR A:0x6200e4d8
y.create.l HWIO_PMIC_ARB_XPU_PRT6_CNTL0_ADDR A:0x6200e558
y.create.l HWIO_PMIC_ARB_XPU_PRT7_CNTL0_ADDR A:0x6200e5d8
y.create.l HWIO_PMIC_ARB_XPU_PRT8_CNTL0_ADDR A:0x6200e658
y.create.l HWIO_PMIC_ARB_XPU_PRT9_CNTL0_ADDR A:0x6200e6d8
y.create.l HWIO_PMIC_ARB_XPU_PRT0_CNTL1_ADDR A:0x6200e25c
y.create.l HWIO_PMIC_ARB_XPU_PRT1_CNTL1_ADDR A:0x6200e2dc
y.create.l HWIO_PMIC_ARB_XPU_PRT2_CNTL1_ADDR A:0x6200e35c
y.create.l HWIO_PMIC_ARB_XPU_PRT3_CNTL1_ADDR A:0x6200e3dc
y.create.l HWIO_PMIC_ARB_XPU_PRT4_CNTL1_ADDR A:0x6200e45c
y.create.l HWIO_PMIC_ARB_XPU_PRT5_CNTL1_ADDR A:0x6200e4dc
y.create.l HWIO_PMIC_ARB_XPU_PRT6_CNTL1_ADDR A:0x6200e55c
y.create.l HWIO_PMIC_ARB_XPU_PRT7_CNTL1_ADDR A:0x6200e5dc
y.create.l HWIO_PMIC_ARB_XPU_PRT8_CNTL1_ADDR A:0x6200e65c
y.create.l HWIO_PMIC_ARB_XPU_PRT9_CNTL1_ADDR A:0x6200e6dc
y.create.l HWIO_PMIC_ARB_HW_VERSION_ADDR A:0x6200f000
y.create.l HWIO_PMIC_ARB_MISC_CONFIG_ADDR A:0x6200f004
y.create.l HWIO_PMIC_ARB_PVC_INTF_CTL_ADDR A:0x6200f008
y.create.l HWIO_PMIC_ARB_PVC_INTF_STATUS_ADDR A:0x6200f00c
y.create.l HWIO_PMIC_ARB_PRIORITIES0_ADDR A:0x6200f100
y.create.l HWIO_PMIC_ARB_PRIORITIES1_ADDR A:0x6200f104
y.create.l HWIO_PMIC_ARB_PRIORITIES2_ADDR A:0x6200f108
y.create.l HWIO_PMIC_ARB_PRIORITIES3_ADDR A:0x6200f10c
y.create.l HWIO_PMIC_ARB_PRIORITIES4_ADDR A:0x6200f110
y.create.l HWIO_PMIC_ARB_PRIORITIES5_ADDR A:0x6200f114
y.create.l HWIO_PMIC_ARB_PRIORITIES6_ADDR A:0x6200f118
y.create.l HWIO_PMIC_ARB_PVC_PORT0_CTL_ADDR A:0x6200f200
y.create.l HWIO_PMIC_ARB_PVC_PORT1_CTL_ADDR A:0x6200f204
y.create.l HWIO_PMIC_ARB_PVC_PORT2_CTL_ADDR A:0x6200f208
y.create.l HWIO_PMIC_ARB_PVC_PORT3_CTL_ADDR A:0x6200f20c
y.create.l HWIO_PMIC_ARB_PVC_PORT4_CTL_ADDR A:0x6200f210
y.create.l HWIO_PMIC_ARB_PVC_PORT5_CTL_ADDR A:0x6200f214
y.create.l HWIO_PMIC_ARB_PVC_PORT0_STATUS_ADDR A:0x6200f280
y.create.l HWIO_PMIC_ARB_PVC_PORT1_STATUS_ADDR A:0x6200f284
y.create.l HWIO_PMIC_ARB_PVC_PORT2_STATUS_ADDR A:0x6200f288
y.create.l HWIO_PMIC_ARB_PVC_PORT3_STATUS_ADDR A:0x6200f28c
y.create.l HWIO_PMIC_ARB_PVC_PORT4_STATUS_ADDR A:0x6200f290
y.create.l HWIO_PMIC_ARB_PVC_PORT5_STATUS_ADDR A:0x6200f294
y.create.l HWIO_PMIC_ARB_PVC0_ADDR0_ADDR A:0x6200f400
y.create.l HWIO_PMIC_ARB_PVC0_ADDR1_ADDR A:0x6200f404
y.create.l HWIO_PMIC_ARB_PVC0_ADDR2_ADDR A:0x6200f408
y.create.l HWIO_PMIC_ARB_PVC0_ADDR3_ADDR A:0x6200f40c
y.create.l HWIO_PMIC_ARB_PVC1_ADDR0_ADDR A:0x6200f420
y.create.l HWIO_PMIC_ARB_PVC1_ADDR1_ADDR A:0x6200f424
y.create.l HWIO_PMIC_ARB_PVC1_ADDR2_ADDR A:0x6200f428
y.create.l HWIO_PMIC_ARB_PVC1_ADDR3_ADDR A:0x6200f42c
y.create.l HWIO_PMIC_ARB_PVC2_ADDR0_ADDR A:0x6200f440
y.create.l HWIO_PMIC_ARB_PVC2_ADDR1_ADDR A:0x6200f444
y.create.l HWIO_PMIC_ARB_PVC2_ADDR2_ADDR A:0x6200f448
y.create.l HWIO_PMIC_ARB_PVC2_ADDR3_ADDR A:0x6200f44c
y.create.l HWIO_PMIC_ARB_PVC3_ADDR0_ADDR A:0x6200f460
y.create.l HWIO_PMIC_ARB_PVC3_ADDR1_ADDR A:0x6200f464
y.create.l HWIO_PMIC_ARB_PVC3_ADDR2_ADDR A:0x6200f468
y.create.l HWIO_PMIC_ARB_PVC3_ADDR3_ADDR A:0x6200f46c
y.create.l HWIO_PMIC_ARB_PVC4_ADDR0_ADDR A:0x6200f480
y.create.l HWIO_PMIC_ARB_PVC4_ADDR1_ADDR A:0x6200f484
y.create.l HWIO_PMIC_ARB_PVC4_ADDR2_ADDR A:0x6200f488
y.create.l HWIO_PMIC_ARB_PVC4_ADDR3_ADDR A:0x6200f48c
y.create.l HWIO_PMIC_ARB_PVC5_ADDR0_ADDR A:0x6200f4a0
y.create.l HWIO_PMIC_ARB_PVC5_ADDR1_ADDR A:0x6200f4a4
y.create.l HWIO_PMIC_ARB_PVC5_ADDR2_ADDR A:0x6200f4a8
y.create.l HWIO_PMIC_ARB_PVC5_ADDR3_ADDR A:0x6200f4ac
y.create.l HWIO_PMIC_ARB_REG_CHNL0_ADDR A:0x6200f800
y.create.l HWIO_PMIC_ARB_REG_CHNL1_ADDR A:0x6200f804
y.create.l HWIO_PMIC_ARB_REG_CHNL2_ADDR A:0x6200f808
y.create.l HWIO_PMIC_ARB_REG_CHNL3_ADDR A:0x6200f80c
y.create.l HWIO_PMIC_ARB_REG_CHNL4_ADDR A:0x6200f810
y.create.l HWIO_PMIC_ARB_REG_CHNL5_ADDR A:0x6200f814
y.create.l HWIO_PMIC_ARB_REG_CHNL6_ADDR A:0x6200f818
y.create.l HWIO_PMIC_ARB_REG_CHNL7_ADDR A:0x6200f81c
y.create.l HWIO_PMIC_ARB_REG_CHNL8_ADDR A:0x6200f820
y.create.l HWIO_PMIC_ARB_REG_CHNL9_ADDR A:0x6200f824
y.create.l HWIO_PMIC_ARB0_CHNL0_CMD_ADDR A:0x62400000
y.create.l HWIO_PMIC_ARB0_CHNL1_CMD_ADDR A:0x62408000
y.create.l HWIO_PMIC_ARB0_CHNL2_CMD_ADDR A:0x62410000
y.create.l HWIO_PMIC_ARB0_CHNL3_CMD_ADDR A:0x62418000
y.create.l HWIO_PMIC_ARB1_CHNL0_CMD_ADDR A:0x62401000
y.create.l HWIO_PMIC_ARB1_CHNL1_CMD_ADDR A:0x62409000
y.create.l HWIO_PMIC_ARB1_CHNL2_CMD_ADDR A:0x62411000
y.create.l HWIO_PMIC_ARB1_CHNL3_CMD_ADDR A:0x62419000
y.create.l HWIO_PMIC_ARB2_CHNL0_CMD_ADDR A:0x62402000
y.create.l HWIO_PMIC_ARB2_CHNL1_CMD_ADDR A:0x6240a000
y.create.l HWIO_PMIC_ARB2_CHNL2_CMD_ADDR A:0x62412000
y.create.l HWIO_PMIC_ARB2_CHNL3_CMD_ADDR A:0x6241a000
y.create.l HWIO_PMIC_ARB3_CHNL0_CMD_ADDR A:0x62403000
y.create.l HWIO_PMIC_ARB3_CHNL1_CMD_ADDR A:0x6240b000
y.create.l HWIO_PMIC_ARB3_CHNL2_CMD_ADDR A:0x62413000
y.create.l HWIO_PMIC_ARB3_CHNL3_CMD_ADDR A:0x6241b000
y.create.l HWIO_PMIC_ARB4_CHNL0_CMD_ADDR A:0x62404000
y.create.l HWIO_PMIC_ARB4_CHNL1_CMD_ADDR A:0x6240c000
y.create.l HWIO_PMIC_ARB4_CHNL2_CMD_ADDR A:0x62414000
y.create.l HWIO_PMIC_ARB4_CHNL3_CMD_ADDR A:0x6241c000
y.create.l HWIO_PMIC_ARB5_CHNL0_CMD_ADDR A:0x62405000
y.create.l HWIO_PMIC_ARB5_CHNL1_CMD_ADDR A:0x6240d000
y.create.l HWIO_PMIC_ARB5_CHNL2_CMD_ADDR A:0x62415000
y.create.l HWIO_PMIC_ARB5_CHNL3_CMD_ADDR A:0x6241d000
y.create.l HWIO_PMIC_ARB0_CHNL0_CONFIG_ADDR A:0x62400004
y.create.l HWIO_PMIC_ARB0_CHNL1_CONFIG_ADDR A:0x62408004
y.create.l HWIO_PMIC_ARB0_CHNL2_CONFIG_ADDR A:0x62410004
y.create.l HWIO_PMIC_ARB0_CHNL3_CONFIG_ADDR A:0x62418004
y.create.l HWIO_PMIC_ARB1_CHNL0_CONFIG_ADDR A:0x62401004
y.create.l HWIO_PMIC_ARB1_CHNL1_CONFIG_ADDR A:0x62409004
y.create.l HWIO_PMIC_ARB1_CHNL2_CONFIG_ADDR A:0x62411004
y.create.l HWIO_PMIC_ARB1_CHNL3_CONFIG_ADDR A:0x62419004
y.create.l HWIO_PMIC_ARB2_CHNL0_CONFIG_ADDR A:0x62402004
y.create.l HWIO_PMIC_ARB2_CHNL1_CONFIG_ADDR A:0x6240a004
y.create.l HWIO_PMIC_ARB2_CHNL2_CONFIG_ADDR A:0x62412004
y.create.l HWIO_PMIC_ARB2_CHNL3_CONFIG_ADDR A:0x6241a004
y.create.l HWIO_PMIC_ARB3_CHNL0_CONFIG_ADDR A:0x62403004
y.create.l HWIO_PMIC_ARB3_CHNL1_CONFIG_ADDR A:0x6240b004
y.create.l HWIO_PMIC_ARB3_CHNL2_CONFIG_ADDR A:0x62413004
y.create.l HWIO_PMIC_ARB3_CHNL3_CONFIG_ADDR A:0x6241b004
y.create.l HWIO_PMIC_ARB4_CHNL0_CONFIG_ADDR A:0x62404004
y.create.l HWIO_PMIC_ARB4_CHNL1_CONFIG_ADDR A:0x6240c004
y.create.l HWIO_PMIC_ARB4_CHNL2_CONFIG_ADDR A:0x62414004
y.create.l HWIO_PMIC_ARB4_CHNL3_CONFIG_ADDR A:0x6241c004
y.create.l HWIO_PMIC_ARB5_CHNL0_CONFIG_ADDR A:0x62405004
y.create.l HWIO_PMIC_ARB5_CHNL1_CONFIG_ADDR A:0x6240d004
y.create.l HWIO_PMIC_ARB5_CHNL2_CONFIG_ADDR A:0x62415004
y.create.l HWIO_PMIC_ARB5_CHNL3_CONFIG_ADDR A:0x6241d004
y.create.l HWIO_PMIC_ARB0_CHNL0_STATUS_ADDR A:0x62400008
y.create.l HWIO_PMIC_ARB0_CHNL1_STATUS_ADDR A:0x62408008
y.create.l HWIO_PMIC_ARB0_CHNL2_STATUS_ADDR A:0x62410008
y.create.l HWIO_PMIC_ARB0_CHNL3_STATUS_ADDR A:0x62418008
y.create.l HWIO_PMIC_ARB1_CHNL0_STATUS_ADDR A:0x62401008
y.create.l HWIO_PMIC_ARB1_CHNL1_STATUS_ADDR A:0x62409008
y.create.l HWIO_PMIC_ARB1_CHNL2_STATUS_ADDR A:0x62411008
y.create.l HWIO_PMIC_ARB1_CHNL3_STATUS_ADDR A:0x62419008
y.create.l HWIO_PMIC_ARB2_CHNL0_STATUS_ADDR A:0x62402008
y.create.l HWIO_PMIC_ARB2_CHNL1_STATUS_ADDR A:0x6240a008
y.create.l HWIO_PMIC_ARB2_CHNL2_STATUS_ADDR A:0x62412008
y.create.l HWIO_PMIC_ARB2_CHNL3_STATUS_ADDR A:0x6241a008
y.create.l HWIO_PMIC_ARB3_CHNL0_STATUS_ADDR A:0x62403008
y.create.l HWIO_PMIC_ARB3_CHNL1_STATUS_ADDR A:0x6240b008
y.create.l HWIO_PMIC_ARB3_CHNL2_STATUS_ADDR A:0x62413008
y.create.l HWIO_PMIC_ARB3_CHNL3_STATUS_ADDR A:0x6241b008
y.create.l HWIO_PMIC_ARB4_CHNL0_STATUS_ADDR A:0x62404008
y.create.l HWIO_PMIC_ARB4_CHNL1_STATUS_ADDR A:0x6240c008
y.create.l HWIO_PMIC_ARB4_CHNL2_STATUS_ADDR A:0x62414008
y.create.l HWIO_PMIC_ARB4_CHNL3_STATUS_ADDR A:0x6241c008
y.create.l HWIO_PMIC_ARB5_CHNL0_STATUS_ADDR A:0x62405008
y.create.l HWIO_PMIC_ARB5_CHNL1_STATUS_ADDR A:0x6240d008
y.create.l HWIO_PMIC_ARB5_CHNL2_STATUS_ADDR A:0x62415008
y.create.l HWIO_PMIC_ARB5_CHNL3_STATUS_ADDR A:0x6241d008
y.create.l HWIO_PMIC_ARB0_CHNL0_WDATA0_ADDR A:0x62400010
y.create.l HWIO_PMIC_ARB0_CHNL1_WDATA0_ADDR A:0x62408010
y.create.l HWIO_PMIC_ARB0_CHNL2_WDATA0_ADDR A:0x62410010
y.create.l HWIO_PMIC_ARB0_CHNL3_WDATA0_ADDR A:0x62418010
y.create.l HWIO_PMIC_ARB1_CHNL0_WDATA0_ADDR A:0x62401010
y.create.l HWIO_PMIC_ARB1_CHNL1_WDATA0_ADDR A:0x62409010
y.create.l HWIO_PMIC_ARB1_CHNL2_WDATA0_ADDR A:0x62411010
y.create.l HWIO_PMIC_ARB1_CHNL3_WDATA0_ADDR A:0x62419010
y.create.l HWIO_PMIC_ARB2_CHNL0_WDATA0_ADDR A:0x62402010
y.create.l HWIO_PMIC_ARB2_CHNL1_WDATA0_ADDR A:0x6240a010
y.create.l HWIO_PMIC_ARB2_CHNL2_WDATA0_ADDR A:0x62412010
y.create.l HWIO_PMIC_ARB2_CHNL3_WDATA0_ADDR A:0x6241a010
y.create.l HWIO_PMIC_ARB3_CHNL0_WDATA0_ADDR A:0x62403010
y.create.l HWIO_PMIC_ARB3_CHNL1_WDATA0_ADDR A:0x6240b010
y.create.l HWIO_PMIC_ARB3_CHNL2_WDATA0_ADDR A:0x62413010
y.create.l HWIO_PMIC_ARB3_CHNL3_WDATA0_ADDR A:0x6241b010
y.create.l HWIO_PMIC_ARB4_CHNL0_WDATA0_ADDR A:0x62404010
y.create.l HWIO_PMIC_ARB4_CHNL1_WDATA0_ADDR A:0x6240c010
y.create.l HWIO_PMIC_ARB4_CHNL2_WDATA0_ADDR A:0x62414010
y.create.l HWIO_PMIC_ARB4_CHNL3_WDATA0_ADDR A:0x6241c010
y.create.l HWIO_PMIC_ARB5_CHNL0_WDATA0_ADDR A:0x62405010
y.create.l HWIO_PMIC_ARB5_CHNL1_WDATA0_ADDR A:0x6240d010
y.create.l HWIO_PMIC_ARB5_CHNL2_WDATA0_ADDR A:0x62415010
y.create.l HWIO_PMIC_ARB5_CHNL3_WDATA0_ADDR A:0x6241d010
y.create.l HWIO_PMIC_ARB0_CHNL0_WDATA1_ADDR A:0x62400014
y.create.l HWIO_PMIC_ARB0_CHNL1_WDATA1_ADDR A:0x62408014
y.create.l HWIO_PMIC_ARB0_CHNL2_WDATA1_ADDR A:0x62410014
y.create.l HWIO_PMIC_ARB0_CHNL3_WDATA1_ADDR A:0x62418014
y.create.l HWIO_PMIC_ARB1_CHNL0_WDATA1_ADDR A:0x62401014
y.create.l HWIO_PMIC_ARB1_CHNL1_WDATA1_ADDR A:0x62409014
y.create.l HWIO_PMIC_ARB1_CHNL2_WDATA1_ADDR A:0x62411014
y.create.l HWIO_PMIC_ARB1_CHNL3_WDATA1_ADDR A:0x62419014
y.create.l HWIO_PMIC_ARB2_CHNL0_WDATA1_ADDR A:0x62402014
y.create.l HWIO_PMIC_ARB2_CHNL1_WDATA1_ADDR A:0x6240a014
y.create.l HWIO_PMIC_ARB2_CHNL2_WDATA1_ADDR A:0x62412014
y.create.l HWIO_PMIC_ARB2_CHNL3_WDATA1_ADDR A:0x6241a014
y.create.l HWIO_PMIC_ARB3_CHNL0_WDATA1_ADDR A:0x62403014
y.create.l HWIO_PMIC_ARB3_CHNL1_WDATA1_ADDR A:0x6240b014
y.create.l HWIO_PMIC_ARB3_CHNL2_WDATA1_ADDR A:0x62413014
y.create.l HWIO_PMIC_ARB3_CHNL3_WDATA1_ADDR A:0x6241b014
y.create.l HWIO_PMIC_ARB4_CHNL0_WDATA1_ADDR A:0x62404014
y.create.l HWIO_PMIC_ARB4_CHNL1_WDATA1_ADDR A:0x6240c014
y.create.l HWIO_PMIC_ARB4_CHNL2_WDATA1_ADDR A:0x62414014
y.create.l HWIO_PMIC_ARB4_CHNL3_WDATA1_ADDR A:0x6241c014
y.create.l HWIO_PMIC_ARB5_CHNL0_WDATA1_ADDR A:0x62405014
y.create.l HWIO_PMIC_ARB5_CHNL1_WDATA1_ADDR A:0x6240d014
y.create.l HWIO_PMIC_ARB5_CHNL2_WDATA1_ADDR A:0x62415014
y.create.l HWIO_PMIC_ARB5_CHNL3_WDATA1_ADDR A:0x6241d014
y.create.l HWIO_PMIC_ARB0_CHNL0_RDATA0_ADDR A:0x62400018
y.create.l HWIO_PMIC_ARB0_CHNL1_RDATA0_ADDR A:0x62408018
y.create.l HWIO_PMIC_ARB0_CHNL2_RDATA0_ADDR A:0x62410018
y.create.l HWIO_PMIC_ARB0_CHNL3_RDATA0_ADDR A:0x62418018
y.create.l HWIO_PMIC_ARB1_CHNL0_RDATA0_ADDR A:0x62401018
y.create.l HWIO_PMIC_ARB1_CHNL1_RDATA0_ADDR A:0x62409018
y.create.l HWIO_PMIC_ARB1_CHNL2_RDATA0_ADDR A:0x62411018
y.create.l HWIO_PMIC_ARB1_CHNL3_RDATA0_ADDR A:0x62419018
y.create.l HWIO_PMIC_ARB2_CHNL0_RDATA0_ADDR A:0x62402018
y.create.l HWIO_PMIC_ARB2_CHNL1_RDATA0_ADDR A:0x6240a018
y.create.l HWIO_PMIC_ARB2_CHNL2_RDATA0_ADDR A:0x62412018
y.create.l HWIO_PMIC_ARB2_CHNL3_RDATA0_ADDR A:0x6241a018
y.create.l HWIO_PMIC_ARB3_CHNL0_RDATA0_ADDR A:0x62403018
y.create.l HWIO_PMIC_ARB3_CHNL1_RDATA0_ADDR A:0x6240b018
y.create.l HWIO_PMIC_ARB3_CHNL2_RDATA0_ADDR A:0x62413018
y.create.l HWIO_PMIC_ARB3_CHNL3_RDATA0_ADDR A:0x6241b018
y.create.l HWIO_PMIC_ARB4_CHNL0_RDATA0_ADDR A:0x62404018
y.create.l HWIO_PMIC_ARB4_CHNL1_RDATA0_ADDR A:0x6240c018
y.create.l HWIO_PMIC_ARB4_CHNL2_RDATA0_ADDR A:0x62414018
y.create.l HWIO_PMIC_ARB4_CHNL3_RDATA0_ADDR A:0x6241c018
y.create.l HWIO_PMIC_ARB5_CHNL0_RDATA0_ADDR A:0x62405018
y.create.l HWIO_PMIC_ARB5_CHNL1_RDATA0_ADDR A:0x6240d018
y.create.l HWIO_PMIC_ARB5_CHNL2_RDATA0_ADDR A:0x62415018
y.create.l HWIO_PMIC_ARB5_CHNL3_RDATA0_ADDR A:0x6241d018
y.create.l HWIO_PMIC_ARB0_CHNL0_RDATA1_ADDR A:0x6240001c
y.create.l HWIO_PMIC_ARB0_CHNL1_RDATA1_ADDR A:0x6240801c
y.create.l HWIO_PMIC_ARB0_CHNL2_RDATA1_ADDR A:0x6241001c
y.create.l HWIO_PMIC_ARB0_CHNL3_RDATA1_ADDR A:0x6241801c
y.create.l HWIO_PMIC_ARB1_CHNL0_RDATA1_ADDR A:0x6240101c
y.create.l HWIO_PMIC_ARB1_CHNL1_RDATA1_ADDR A:0x6240901c
y.create.l HWIO_PMIC_ARB1_CHNL2_RDATA1_ADDR A:0x6241101c
y.create.l HWIO_PMIC_ARB1_CHNL3_RDATA1_ADDR A:0x6241901c
y.create.l HWIO_PMIC_ARB2_CHNL0_RDATA1_ADDR A:0x6240201c
y.create.l HWIO_PMIC_ARB2_CHNL1_RDATA1_ADDR A:0x6240a01c
y.create.l HWIO_PMIC_ARB2_CHNL2_RDATA1_ADDR A:0x6241201c
y.create.l HWIO_PMIC_ARB2_CHNL3_RDATA1_ADDR A:0x6241a01c
y.create.l HWIO_PMIC_ARB3_CHNL0_RDATA1_ADDR A:0x6240301c
y.create.l HWIO_PMIC_ARB3_CHNL1_RDATA1_ADDR A:0x6240b01c
y.create.l HWIO_PMIC_ARB3_CHNL2_RDATA1_ADDR A:0x6241301c
y.create.l HWIO_PMIC_ARB3_CHNL3_RDATA1_ADDR A:0x6241b01c
y.create.l HWIO_PMIC_ARB4_CHNL0_RDATA1_ADDR A:0x6240401c
y.create.l HWIO_PMIC_ARB4_CHNL1_RDATA1_ADDR A:0x6240c01c
y.create.l HWIO_PMIC_ARB4_CHNL2_RDATA1_ADDR A:0x6241401c
y.create.l HWIO_PMIC_ARB4_CHNL3_RDATA1_ADDR A:0x6241c01c
y.create.l HWIO_PMIC_ARB5_CHNL0_RDATA1_ADDR A:0x6240501c
y.create.l HWIO_PMIC_ARB5_CHNL1_RDATA1_ADDR A:0x6240d01c
y.create.l HWIO_PMIC_ARB5_CHNL2_RDATA1_ADDR A:0x6241501c
y.create.l HWIO_PMIC_ARB5_CHNL3_RDATA1_ADDR A:0x6241d01c
y.create.l HWIO_PMIC_ARB0_CHNL0_RDATA2_ADDR A:0x62400020
y.create.l HWIO_PMIC_ARB0_CHNL1_RDATA2_ADDR A:0x62408020
y.create.l HWIO_PMIC_ARB0_CHNL2_RDATA2_ADDR A:0x62410020
y.create.l HWIO_PMIC_ARB0_CHNL3_RDATA2_ADDR A:0x62418020
y.create.l HWIO_PMIC_ARB1_CHNL0_RDATA2_ADDR A:0x62401020
y.create.l HWIO_PMIC_ARB1_CHNL1_RDATA2_ADDR A:0x62409020
y.create.l HWIO_PMIC_ARB1_CHNL2_RDATA2_ADDR A:0x62411020
y.create.l HWIO_PMIC_ARB1_CHNL3_RDATA2_ADDR A:0x62419020
y.create.l HWIO_PMIC_ARB2_CHNL0_RDATA2_ADDR A:0x62402020
y.create.l HWIO_PMIC_ARB2_CHNL1_RDATA2_ADDR A:0x6240a020
y.create.l HWIO_PMIC_ARB2_CHNL2_RDATA2_ADDR A:0x62412020
y.create.l HWIO_PMIC_ARB2_CHNL3_RDATA2_ADDR A:0x6241a020
y.create.l HWIO_PMIC_ARB3_CHNL0_RDATA2_ADDR A:0x62403020
y.create.l HWIO_PMIC_ARB3_CHNL1_RDATA2_ADDR A:0x6240b020
y.create.l HWIO_PMIC_ARB3_CHNL2_RDATA2_ADDR A:0x62413020
y.create.l HWIO_PMIC_ARB3_CHNL3_RDATA2_ADDR A:0x6241b020
y.create.l HWIO_PMIC_ARB4_CHNL0_RDATA2_ADDR A:0x62404020
y.create.l HWIO_PMIC_ARB4_CHNL1_RDATA2_ADDR A:0x6240c020
y.create.l HWIO_PMIC_ARB4_CHNL2_RDATA2_ADDR A:0x62414020
y.create.l HWIO_PMIC_ARB4_CHNL3_RDATA2_ADDR A:0x6241c020
y.create.l HWIO_PMIC_ARB5_CHNL0_RDATA2_ADDR A:0x62405020
y.create.l HWIO_PMIC_ARB5_CHNL1_RDATA2_ADDR A:0x6240d020
y.create.l HWIO_PMIC_ARB5_CHNL2_RDATA2_ADDR A:0x62415020
y.create.l HWIO_PMIC_ARB5_CHNL3_RDATA2_ADDR A:0x6241d020
y.create.l HWIO_PMIC_ARB_OBS0_CHNL0_CMD_ADDR A:0x62c00000
y.create.l HWIO_PMIC_ARB_OBS0_CHNL1_CMD_ADDR A:0x62c08000
y.create.l HWIO_PMIC_ARB_OBS0_CHNL2_CMD_ADDR A:0x62c10000
y.create.l HWIO_PMIC_ARB_OBS0_CHNL3_CMD_ADDR A:0x62c18000
y.create.l HWIO_PMIC_ARB_OBS1_CHNL0_CMD_ADDR A:0x62c01000
y.create.l HWIO_PMIC_ARB_OBS1_CHNL1_CMD_ADDR A:0x62c09000
y.create.l HWIO_PMIC_ARB_OBS1_CHNL2_CMD_ADDR A:0x62c11000
y.create.l HWIO_PMIC_ARB_OBS1_CHNL3_CMD_ADDR A:0x62c19000
y.create.l HWIO_PMIC_ARB_OBS2_CHNL0_CMD_ADDR A:0x62c02000
y.create.l HWIO_PMIC_ARB_OBS2_CHNL1_CMD_ADDR A:0x62c0a000
y.create.l HWIO_PMIC_ARB_OBS2_CHNL2_CMD_ADDR A:0x62c12000
y.create.l HWIO_PMIC_ARB_OBS2_CHNL3_CMD_ADDR A:0x62c1a000
y.create.l HWIO_PMIC_ARB_OBS3_CHNL0_CMD_ADDR A:0x62c03000
y.create.l HWIO_PMIC_ARB_OBS3_CHNL1_CMD_ADDR A:0x62c0b000
y.create.l HWIO_PMIC_ARB_OBS3_CHNL2_CMD_ADDR A:0x62c13000
y.create.l HWIO_PMIC_ARB_OBS3_CHNL3_CMD_ADDR A:0x62c1b000
y.create.l HWIO_PMIC_ARB_OBS4_CHNL0_CMD_ADDR A:0x62c04000
y.create.l HWIO_PMIC_ARB_OBS4_CHNL1_CMD_ADDR A:0x62c0c000
y.create.l HWIO_PMIC_ARB_OBS4_CHNL2_CMD_ADDR A:0x62c14000
y.create.l HWIO_PMIC_ARB_OBS4_CHNL3_CMD_ADDR A:0x62c1c000
y.create.l HWIO_PMIC_ARB_OBS5_CHNL0_CMD_ADDR A:0x62c05000
y.create.l HWIO_PMIC_ARB_OBS5_CHNL1_CMD_ADDR A:0x62c0d000
y.create.l HWIO_PMIC_ARB_OBS5_CHNL2_CMD_ADDR A:0x62c15000
y.create.l HWIO_PMIC_ARB_OBS5_CHNL3_CMD_ADDR A:0x62c1d000
y.create.l HWIO_PMIC_ARB_OBS0_CHNL0_CONFIG_ADDR A:0x62c00004
y.create.l HWIO_PMIC_ARB_OBS0_CHNL1_CONFIG_ADDR A:0x62c08004
y.create.l HWIO_PMIC_ARB_OBS0_CHNL2_CONFIG_ADDR A:0x62c10004
y.create.l HWIO_PMIC_ARB_OBS0_CHNL3_CONFIG_ADDR A:0x62c18004
y.create.l HWIO_PMIC_ARB_OBS1_CHNL0_CONFIG_ADDR A:0x62c01004
y.create.l HWIO_PMIC_ARB_OBS1_CHNL1_CONFIG_ADDR A:0x62c09004
y.create.l HWIO_PMIC_ARB_OBS1_CHNL2_CONFIG_ADDR A:0x62c11004
y.create.l HWIO_PMIC_ARB_OBS1_CHNL3_CONFIG_ADDR A:0x62c19004
y.create.l HWIO_PMIC_ARB_OBS2_CHNL0_CONFIG_ADDR A:0x62c02004
y.create.l HWIO_PMIC_ARB_OBS2_CHNL1_CONFIG_ADDR A:0x62c0a004
y.create.l HWIO_PMIC_ARB_OBS2_CHNL2_CONFIG_ADDR A:0x62c12004
y.create.l HWIO_PMIC_ARB_OBS2_CHNL3_CONFIG_ADDR A:0x62c1a004
y.create.l HWIO_PMIC_ARB_OBS3_CHNL0_CONFIG_ADDR A:0x62c03004
y.create.l HWIO_PMIC_ARB_OBS3_CHNL1_CONFIG_ADDR A:0x62c0b004
y.create.l HWIO_PMIC_ARB_OBS3_CHNL2_CONFIG_ADDR A:0x62c13004
y.create.l HWIO_PMIC_ARB_OBS3_CHNL3_CONFIG_ADDR A:0x62c1b004
y.create.l HWIO_PMIC_ARB_OBS4_CHNL0_CONFIG_ADDR A:0x62c04004
y.create.l HWIO_PMIC_ARB_OBS4_CHNL1_CONFIG_ADDR A:0x62c0c004
y.create.l HWIO_PMIC_ARB_OBS4_CHNL2_CONFIG_ADDR A:0x62c14004
y.create.l HWIO_PMIC_ARB_OBS4_CHNL3_CONFIG_ADDR A:0x62c1c004
y.create.l HWIO_PMIC_ARB_OBS5_CHNL0_CONFIG_ADDR A:0x62c05004
y.create.l HWIO_PMIC_ARB_OBS5_CHNL1_CONFIG_ADDR A:0x62c0d004
y.create.l HWIO_PMIC_ARB_OBS5_CHNL2_CONFIG_ADDR A:0x62c15004
y.create.l HWIO_PMIC_ARB_OBS5_CHNL3_CONFIG_ADDR A:0x62c1d004
y.create.l HWIO_PMIC_ARB_OBS0_CHNL0_STATUS_ADDR A:0x62c00008
y.create.l HWIO_PMIC_ARB_OBS0_CHNL1_STATUS_ADDR A:0x62c08008
y.create.l HWIO_PMIC_ARB_OBS0_CHNL2_STATUS_ADDR A:0x62c10008
y.create.l HWIO_PMIC_ARB_OBS0_CHNL3_STATUS_ADDR A:0x62c18008
y.create.l HWIO_PMIC_ARB_OBS1_CHNL0_STATUS_ADDR A:0x62c01008
y.create.l HWIO_PMIC_ARB_OBS1_CHNL1_STATUS_ADDR A:0x62c09008
y.create.l HWIO_PMIC_ARB_OBS1_CHNL2_STATUS_ADDR A:0x62c11008
y.create.l HWIO_PMIC_ARB_OBS1_CHNL3_STATUS_ADDR A:0x62c19008
y.create.l HWIO_PMIC_ARB_OBS2_CHNL0_STATUS_ADDR A:0x62c02008
y.create.l HWIO_PMIC_ARB_OBS2_CHNL1_STATUS_ADDR A:0x62c0a008
y.create.l HWIO_PMIC_ARB_OBS2_CHNL2_STATUS_ADDR A:0x62c12008
y.create.l HWIO_PMIC_ARB_OBS2_CHNL3_STATUS_ADDR A:0x62c1a008
y.create.l HWIO_PMIC_ARB_OBS3_CHNL0_STATUS_ADDR A:0x62c03008
y.create.l HWIO_PMIC_ARB_OBS3_CHNL1_STATUS_ADDR A:0x62c0b008
y.create.l HWIO_PMIC_ARB_OBS3_CHNL2_STATUS_ADDR A:0x62c13008
y.create.l HWIO_PMIC_ARB_OBS3_CHNL3_STATUS_ADDR A:0x62c1b008
y.create.l HWIO_PMIC_ARB_OBS4_CHNL0_STATUS_ADDR A:0x62c04008
y.create.l HWIO_PMIC_ARB_OBS4_CHNL1_STATUS_ADDR A:0x62c0c008
y.create.l HWIO_PMIC_ARB_OBS4_CHNL2_STATUS_ADDR A:0x62c14008
y.create.l HWIO_PMIC_ARB_OBS4_CHNL3_STATUS_ADDR A:0x62c1c008
y.create.l HWIO_PMIC_ARB_OBS5_CHNL0_STATUS_ADDR A:0x62c05008
y.create.l HWIO_PMIC_ARB_OBS5_CHNL1_STATUS_ADDR A:0x62c0d008
y.create.l HWIO_PMIC_ARB_OBS5_CHNL2_STATUS_ADDR A:0x62c15008
y.create.l HWIO_PMIC_ARB_OBS5_CHNL3_STATUS_ADDR A:0x62c1d008
y.create.l HWIO_PMIC_ARB_OBS0_CHNL0_RDATA0_ADDR A:0x62c00018
y.create.l HWIO_PMIC_ARB_OBS0_CHNL1_RDATA0_ADDR A:0x62c08018
y.create.l HWIO_PMIC_ARB_OBS0_CHNL2_RDATA0_ADDR A:0x62c10018
y.create.l HWIO_PMIC_ARB_OBS0_CHNL3_RDATA0_ADDR A:0x62c18018
y.create.l HWIO_PMIC_ARB_OBS1_CHNL0_RDATA0_ADDR A:0x62c01018
y.create.l HWIO_PMIC_ARB_OBS1_CHNL1_RDATA0_ADDR A:0x62c09018
y.create.l HWIO_PMIC_ARB_OBS1_CHNL2_RDATA0_ADDR A:0x62c11018
y.create.l HWIO_PMIC_ARB_OBS1_CHNL3_RDATA0_ADDR A:0x62c19018
y.create.l HWIO_PMIC_ARB_OBS2_CHNL0_RDATA0_ADDR A:0x62c02018
y.create.l HWIO_PMIC_ARB_OBS2_CHNL1_RDATA0_ADDR A:0x62c0a018
y.create.l HWIO_PMIC_ARB_OBS2_CHNL2_RDATA0_ADDR A:0x62c12018
y.create.l HWIO_PMIC_ARB_OBS2_CHNL3_RDATA0_ADDR A:0x62c1a018
y.create.l HWIO_PMIC_ARB_OBS3_CHNL0_RDATA0_ADDR A:0x62c03018
y.create.l HWIO_PMIC_ARB_OBS3_CHNL1_RDATA0_ADDR A:0x62c0b018
y.create.l HWIO_PMIC_ARB_OBS3_CHNL2_RDATA0_ADDR A:0x62c13018
y.create.l HWIO_PMIC_ARB_OBS3_CHNL3_RDATA0_ADDR A:0x62c1b018
y.create.l HWIO_PMIC_ARB_OBS4_CHNL0_RDATA0_ADDR A:0x62c04018
y.create.l HWIO_PMIC_ARB_OBS4_CHNL1_RDATA0_ADDR A:0x62c0c018
y.create.l HWIO_PMIC_ARB_OBS4_CHNL2_RDATA0_ADDR A:0x62c14018
y.create.l HWIO_PMIC_ARB_OBS4_CHNL3_RDATA0_ADDR A:0x62c1c018
y.create.l HWIO_PMIC_ARB_OBS5_CHNL0_RDATA0_ADDR A:0x62c05018
y.create.l HWIO_PMIC_ARB_OBS5_CHNL1_RDATA0_ADDR A:0x62c0d018
y.create.l HWIO_PMIC_ARB_OBS5_CHNL2_RDATA0_ADDR A:0x62c15018
y.create.l HWIO_PMIC_ARB_OBS5_CHNL3_RDATA0_ADDR A:0x62c1d018
y.create.l HWIO_PMIC_ARB_OBS0_CHNL0_RDATA1_ADDR A:0x62c0001c
y.create.l HWIO_PMIC_ARB_OBS0_CHNL1_RDATA1_ADDR A:0x62c0801c
y.create.l HWIO_PMIC_ARB_OBS0_CHNL2_RDATA1_ADDR A:0x62c1001c
y.create.l HWIO_PMIC_ARB_OBS0_CHNL3_RDATA1_ADDR A:0x62c1801c
y.create.l HWIO_PMIC_ARB_OBS1_CHNL0_RDATA1_ADDR A:0x62c0101c
y.create.l HWIO_PMIC_ARB_OBS1_CHNL1_RDATA1_ADDR A:0x62c0901c
y.create.l HWIO_PMIC_ARB_OBS1_CHNL2_RDATA1_ADDR A:0x62c1101c
y.create.l HWIO_PMIC_ARB_OBS1_CHNL3_RDATA1_ADDR A:0x62c1901c
y.create.l HWIO_PMIC_ARB_OBS2_CHNL0_RDATA1_ADDR A:0x62c0201c
y.create.l HWIO_PMIC_ARB_OBS2_CHNL1_RDATA1_ADDR A:0x62c0a01c
y.create.l HWIO_PMIC_ARB_OBS2_CHNL2_RDATA1_ADDR A:0x62c1201c
y.create.l HWIO_PMIC_ARB_OBS2_CHNL3_RDATA1_ADDR A:0x62c1a01c
y.create.l HWIO_PMIC_ARB_OBS3_CHNL0_RDATA1_ADDR A:0x62c0301c
y.create.l HWIO_PMIC_ARB_OBS3_CHNL1_RDATA1_ADDR A:0x62c0b01c
y.create.l HWIO_PMIC_ARB_OBS3_CHNL2_RDATA1_ADDR A:0x62c1301c
y.create.l HWIO_PMIC_ARB_OBS3_CHNL3_RDATA1_ADDR A:0x62c1b01c
y.create.l HWIO_PMIC_ARB_OBS4_CHNL0_RDATA1_ADDR A:0x62c0401c
y.create.l HWIO_PMIC_ARB_OBS4_CHNL1_RDATA1_ADDR A:0x62c0c01c
y.create.l HWIO_PMIC_ARB_OBS4_CHNL2_RDATA1_ADDR A:0x62c1401c
y.create.l HWIO_PMIC_ARB_OBS4_CHNL3_RDATA1_ADDR A:0x62c1c01c
y.create.l HWIO_PMIC_ARB_OBS5_CHNL0_RDATA1_ADDR A:0x62c0501c
y.create.l HWIO_PMIC_ARB_OBS5_CHNL1_RDATA1_ADDR A:0x62c0d01c
y.create.l HWIO_PMIC_ARB_OBS5_CHNL2_RDATA1_ADDR A:0x62c1501c
y.create.l HWIO_PMIC_ARB_OBS5_CHNL3_RDATA1_ADDR A:0x62c1d01c
y.create.l HWIO_PRNG_PRNG_DATA_OUT_ADDR A:0x60022000
y.create.l HWIO_PRNG_PRNG_STATUS_ADDR A:0x60022004
y.create.l HWIO_PRNG_PRNG_HW_VERSION_ADDR A:0x60022008
y.create.l HWIO_PRNG_PRNG_ENTROPY_CNTR_ADDR A:0x60022010
y.create.l HWIO_PRNG_PRNG_SAMPLE_CNTR_ADDR A:0x60022014
y.create.l HWIO_PRNG_PRNG_GEN_CNTR_ADDR A:0x60022018
y.create.l HWIO_PRNG_PRNG_RESEED_CNTR_ADDR A:0x6002201c
y.create.l HWIO_PRNG_PRNG_INSTANTIATE_CNTR_ADDR A:0x60022020
y.create.l HWIO_PRNG_PRNG_DEBUG_ADDR A:0x60022024
y.create.l HWIO_PRNG_PRNG_LFSR_CFG_ADDR A:0x60022100
y.create.l HWIO_PRNG_PRNG_CONFIG_ADDR A:0x60022104
y.create.l HWIO_PRNG_PRNG_PERSONALIZATION_STRING_ADDR A:0x60022108
y.create.l HWIO_PRNG_PRNG_NUM_ENTROPY_ADDR A:0x60022110
y.create.l HWIO_PRNG_PRNG_SAMPLE_FREQ_ADDR A:0x60022114
y.create.l HWIO_PRNG_PRNG_GEN_WORDS_ADDR A:0x60022118
y.create.l HWIO_PRNG_PRNG_RESEED_FREQ_ADDR A:0x6002211c
y.create.l HWIO_PRNG_PRNG_INSTANTIATE_FREQ_ADDR A:0x60022120
y.create.l HWIO_QDSS_CORESIGHT_CSR_ROM_WORD_ADDR A:0x60800000
y.create.l HWIO_QDSS_STM_ROM_WORD_ADDR A:0x60800004
y.create.l HWIO_QDSS_CTI0_ROM_WORD_ADDR A:0x60800008
y.create.l HWIO_QDSS_CTI1_ROM_WORD_ADDR A:0x6080000c
y.create.l HWIO_QDSS_CTI2_ROM_WORD_ADDR A:0x60800010
y.create.l HWIO_QDSS_CTI3_ROM_WORD_ADDR A:0x60800014
y.create.l HWIO_QDSS_CTI4_ROM_WORD_ADDR A:0x60800018
y.create.l HWIO_QDSS_CTI5_ROM_WORD_ADDR A:0x6080001c
y.create.l HWIO_QDSS_CTI6_ROM_WORD_ADDR A:0x60800020
y.create.l HWIO_QDSS_CTI7_ROM_WORD_ADDR A:0x60800024
y.create.l HWIO_QDSS_CTI8_ROM_WORD_ADDR A:0x60800028
y.create.l HWIO_QDSS_TPIU_ROM_WORD_ADDR A:0x6080002c
y.create.l HWIO_QDSS_TFUN0_ROM_WORD_ADDR A:0x60800030
y.create.l HWIO_QDSS_TREPL_ROM_WORD_ADDR A:0x60800034
y.create.l HWIO_QDSS_ETBETF_ROM_WORD_ADDR A:0x60800038
y.create.l HWIO_QDSS_ETR_ROM_WORD_ADDR A:0x6080003c
y.create.l HWIO_QDSS_VENUS_CTI_ROM_WORD_ADDR A:0x60800040
y.create.l HWIO_QDSS_VENUS_A9_ETM_ROM_WORD_ADDR A:0x60800044
y.create.l HWIO_QDSS_PRONTO_A9_ETM_ROM_WORD_ADDR A:0x60800048
y.create.l HWIO_QDSS_PRONTO_A9_CTI_ROM_WORD_ADDR A:0x6080004c
y.create.l HWIO_QDSS_MSS_Q6_CTI_ROM_WORD_ADDR A:0x60800050
y.create.l HWIO_QDSS_RPM_CM3_CTI_ROM_WORD_ADDR A:0x60800054
y.create.l HWIO_QDSS_A7SS_PC0_DBG_ROM_WORD_ADDR A:0x60800058
y.create.l HWIO_QDSS_A7SS_PC0_PM_ROM_WORD_ADDR A:0x6080005c
y.create.l HWIO_QDSS_A7SS_PC1_DBG_ROM_WORD_ADDR A:0x60800060
y.create.l HWIO_QDSS_A7SS_PC1_PM_ROM_WORD_ADDR A:0x60800064
y.create.l HWIO_QDSS_A7SS_PC2_DBG_ROM_WORD_ADDR A:0x60800068
y.create.l HWIO_QDSS_A7SS_PC2_PM_ROM_WORD_ADDR A:0x6080006c
y.create.l HWIO_QDSS_A7SS_PC3_DBG_ROM_WORD_ADDR A:0x60800070
y.create.l HWIO_QDSS_A7SS_PC3_PM_ROM_WORD_ADDR A:0x60800074
y.create.l HWIO_QDSS_A7SS_PC0_ETM_ROM_WORD_ADDR A:0x60800078
y.create.l HWIO_QDSS_A7SS_PC1_ETM_ROM_WORD_ADDR A:0x6080007c
y.create.l HWIO_QDSS_A7SS_PC2_ETM_ROM_WORD_ADDR A:0x60800080
y.create.l HWIO_QDSS_A7SS_PC3_ETM_ROM_WORD_ADDR A:0x60800084
y.create.l HWIO_QDSS_A7SS_PC0_CTI_ROM_WORD_ADDR A:0x60800088
y.create.l HWIO_QDSS_A7SS_PC1_CTI_ROM_WORD_ADDR A:0x6080008c
y.create.l HWIO_QDSS_A7SS_PC2_CTI_ROM_WORD_ADDR A:0x60800090
y.create.l HWIO_QDSS_A7SS_PC3_CTI_ROM_WORD_ADDR A:0x60800094
y.create.l HWIO_QDSS_A7SS_TFUNNEL_ROM_WORD_ADDR A:0x60800098
y.create.l HWIO_QDSS_QDSS_WRAPPER_2X1_FUNNEL_ROM_WORD_ADDR A:0x6080009c
y.create.l HWIO_QDSS_QDSS_WRAPPER_8X1_FUNNEL_ROM_WORD_ADDR A:0x608000a0
y.create.l HWIO_QDSS_HWE_EXPD_MUX_CFG_ROM_WORD_ADDR A:0x608000a4
y.create.l HWIO_QDSS_DBGUI_CFG_ROM_WORD_ADDR A:0x608000a8
y.create.l HWIO_QDSS_DAPROM_PERIPHERAL_ID4_ADDR A:0x60800fd0
y.create.l HWIO_QDSS_DAPROM_PERIPHERAL_ID5_ADDR A:0x60800fd4
y.create.l HWIO_QDSS_DAPROM_PERIPHERAL_ID6_ADDR A:0x60800fd8
y.create.l HWIO_QDSS_DAPROM_PERIPHERAL_ID7_ADDR A:0x60800fdc
y.create.l HWIO_QDSS_DAPROM_PERIPHERAL_ID0_ADDR A:0x60800fe0
y.create.l HWIO_QDSS_DAPROM_PERIPHERAL_ID1_ADDR A:0x60800fe4
y.create.l HWIO_QDSS_DAPROM_PERIPHERAL_ID2_ADDR A:0x60800fe8
y.create.l HWIO_QDSS_DAPROM_PERIPHERAL_ID3_ADDR A:0x60800fec
y.create.l HWIO_QDSS_DAPROM_COMPONENT_ID0_ADDR A:0x60800ff0
y.create.l HWIO_QDSS_DAPROM_COMPONENT_ID1_ADDR A:0x60800ff4
y.create.l HWIO_QDSS_DAPROM_COMPONENT_ID2_ADDR A:0x60800ff8
y.create.l HWIO_QDSS_DAPROM_COMPONENT_ID3_ADDR A:0x60800ffc
y.create.l HWIO_QDSS_CS_QDSSCSR_SWDBGPWRCTRL_ADDR A:0x60801000
y.create.l HWIO_QDSS_CS_QDSSCSR_SWDBGPWRACK_ADDR A:0x60801004
y.create.l HWIO_QDSS_CS_QDSSCSR_SWSPADREG0_ADDR A:0x60801008
y.create.l HWIO_QDSS_CS_QDSSCSR_SWSPADREG1_ADDR A:0x6080100c
y.create.l HWIO_QDSS_CS_QDSSCSR_STMTRANSCTRL_ADDR A:0x60801010
y.create.l HWIO_QDSS_CS_QDSSCSR_STMAWIDCTRL_ADDR A:0x60801014
y.create.l HWIO_QDSS_CS_QDSSCSR_STMCHNOFST0_ADDR A:0x60801018
y.create.l HWIO_QDSS_CS_QDSSCSR_STMCHNOFST1_ADDR A:0x6080101c
y.create.l HWIO_QDSS_CS_QDSSCSR_STMEXTHWCTRL0_ADDR A:0x60801020
y.create.l HWIO_QDSS_CS_QDSSCSR_STMEXTHWCTRL1_ADDR A:0x60801024
y.create.l HWIO_QDSS_CS_QDSSCSR_STMEXTHWCTRL2_ADDR A:0x60801028
y.create.l HWIO_QDSS_CS_QDSSCSR_STMEXTHWCTRL3_ADDR A:0x6080102c
y.create.l HWIO_QDSS_CS_QDSSCSR_USBBAMCTRL_ADDR A:0x60801030
y.create.l HWIO_QDSS_CS_QDSSCSR_USBFLSHCTRL_ADDR A:0x60801034
y.create.l HWIO_QDSS_CS_QDSSCSR_TIMESTAMPCTRL_ADDR A:0x60801038
y.create.l HWIO_QDSS_CS_QDSSCSR_AOTIMEVAL0_ADDR A:0x6080103c
y.create.l HWIO_QDSS_CS_QDSSCSR_AOTIMEVAL1_ADDR A:0x60801040
y.create.l HWIO_QDSS_CS_QDSSCSR_QDSSTIMEVAL0_ADDR A:0x60801044
y.create.l HWIO_QDSS_CS_QDSSCSR_QDSSTIMEVAL1_ADDR A:0x60801048
y.create.l HWIO_QDSS_CS_QDSSCSR_QDSSTIMELOAD0_ADDR A:0x6080104c
y.create.l HWIO_QDSS_CS_QDSSCSR_QDSSTIMELOAD1_ADDR A:0x60801050
y.create.l HWIO_QDSS_CS_QDSSCSR_DAPMSAVAL_ADDR A:0x60801054
y.create.l HWIO_QDSS_CS_QDSSCSR_QDSSCLKVOTE_ADDR A:0x60801058
y.create.l HWIO_QDSS_CS_QDSSCSR_QDSSCLKIPI_ADDR A:0x6080105c
y.create.l HWIO_QDSS_CS_QDSSCSR_QDSSPWRREQIGNORE_ADDR A:0x60801060
y.create.l HWIO_QDSS_CS_QDSSCSR_QDSSSPARE_ADDR A:0x60801064
y.create.l HWIO_QDSS_CS_QDSSCSR_IPCAT_ADDR A:0x60801068
y.create.l HWIO_QDSS_CS_QDSSCSR_ETRIRQCTRL_ADDR A:0x6080106c
y.create.l HWIO_QDSS_CS_QDSSCSR_PRESERVEETF_ADDR A:0x60801070
y.create.l HWIO_QDSS_CS_QDSSCSR_PRESERVEETR0_ADDR A:0x60801074
y.create.l HWIO_QDSS_CS_QDSSCSR_PRESERVEETR1_ADDR A:0x60801078
y.create.l HWIO_QDSS_CS_QDSSCSR_ITCTL_ADDR A:0x60801f00
y.create.l HWIO_QDSS_CS_QDSSCSR_CLAIMSET_ADDR A:0x60801fa0
y.create.l HWIO_QDSS_CS_QDSSCSR_CLAIMCLR_ADDR A:0x60801fa4
y.create.l HWIO_QDSS_CS_QDSSCSR_LOCKACCESS_ADDR A:0x60801fb0
y.create.l HWIO_QDSS_CS_QDSSCSR_LOCKSTATUS_ADDR A:0x60801fb4
y.create.l HWIO_QDSS_CS_QDSSCSR_AUTHSTATUS_ADDR A:0x60801fb8
y.create.l HWIO_QDSS_CS_QDSSCSR_DEVICEID_ADDR A:0x60801fc8
y.create.l HWIO_QDSS_CS_QDSSCSR_DEVICETYPE_ADDR A:0x60801fcc
y.create.l HWIO_QDSS_CS_QDSSCSR_PERIPHID4_ADDR A:0x60801fd0
y.create.l HWIO_QDSS_CS_QDSSCSR_PERIPHID5_ADDR A:0x60801fd4
y.create.l HWIO_QDSS_CS_QDSSCSR_PERIPHID6_ADDR A:0x60801fd8
y.create.l HWIO_QDSS_CS_QDSSCSR_PERIPHID7_ADDR A:0x60801fdc
y.create.l HWIO_QDSS_CS_QDSSCSR_PERIPHID0_ADDR A:0x60801fe0
y.create.l HWIO_QDSS_CS_QDSSCSR_PERIPHID1_ADDR A:0x60801fe4
y.create.l HWIO_QDSS_CS_QDSSCSR_PERIPHID2_ADDR A:0x60801fe8
y.create.l HWIO_QDSS_CS_QDSSCSR_PERIPHID3_ADDR A:0x60801fec
y.create.l HWIO_QDSS_CS_QDSSCSR_COMPID0_ADDR A:0x60801ff0
y.create.l HWIO_QDSS_CS_QDSSCSR_COMPID1_ADDR A:0x60801ff4
y.create.l HWIO_QDSS_CS_QDSSCSR_COMPID2_ADDR A:0x60801ff8
y.create.l HWIO_QDSS_CS_QDSSCSR_COMPID3_ADDR A:0x60801ffc
y.create.l HWIO_QDSS_STMDMASTARTR_ADDR A:0x60802c04
y.create.l HWIO_QDSS_STMDMASTOPR_ADDR A:0x60802c08
y.create.l HWIO_QDSS_STMDMASTATR_ADDR A:0x60802c0c
y.create.l HWIO_QDSS_STMDMACTLR_ADDR A:0x60802c10
y.create.l HWIO_QDSS_STMDMAIDR_ADDR A:0x60802cfc
y.create.l HWIO_QDSS_STMHEER_ADDR A:0x60802d00
y.create.l HWIO_QDSS_STMHETER_ADDR A:0x60802d20
y.create.l HWIO_QDSS_STMHEMCR_ADDR A:0x60802d64
y.create.l HWIO_QDSS_STMHEMASTR_ADDR A:0x60802df4
y.create.l HWIO_QDSS_STMHEFEAT1R_ADDR A:0x60802df8
y.create.l HWIO_QDSS_STMHEIDR_ADDR A:0x60802dfc
y.create.l HWIO_QDSS_STMSPER_ADDR A:0x60802e00
y.create.l HWIO_QDSS_STMSPTER_ADDR A:0x60802e20
y.create.l HWIO_QDSS_STMSPSCR_ADDR A:0x60802e60
y.create.l HWIO_QDSS_STMSPMSCR_ADDR A:0x60802e64
y.create.l HWIO_QDSS_STMSPOVERRIDER_ADDR A:0x60802e68
y.create.l HWIO_QDSS_STMSPMOVERRIDER_ADDR A:0x60802e6c
y.create.l HWIO_QDSS_STMSPTRIGCSR_ADDR A:0x60802e70
y.create.l HWIO_QDSS_STMTCSR_ADDR A:0x60802e80
y.create.l HWIO_QDSS_STMTSSTIMR_ADDR A:0x60802e84
y.create.l HWIO_QDSS_STMTSFREQR_ADDR A:0x60802e8c
y.create.l HWIO_QDSS_STMSYNCR_ADDR A:0x60802e90
y.create.l HWIO_QDSS_STMAUXCR_ADDR A:0x60802e94
y.create.l HWIO_QDSS_STMSPFEAT1R_ADDR A:0x60802ea0
y.create.l HWIO_QDSS_STMSPFEAT2R_ADDR A:0x60802ea4
y.create.l HWIO_QDSS_STMSPFEAT3R_ADDR A:0x60802ea8
y.create.l HWIO_QDSS_STMITTRIGGER_ADDR A:0x60802ee8
y.create.l HWIO_QDSS_STMITATBDATA0_ADDR A:0x60802eec
y.create.l HWIO_QDSS_STMITATBCTR2_ADDR A:0x60802ef0
y.create.l HWIO_QDSS_STMITATBID_ADDR A:0x60802ef4
y.create.l HWIO_QDSS_STMITATBCTR0_ADDR A:0x60802ef8
y.create.l HWIO_QDSS_STMITCTRL_ADDR A:0x60802f00
y.create.l HWIO_QDSS_STMCLAIMSET_ADDR A:0x60802fa0
y.create.l HWIO_QDSS_STMCLAIMCLR_ADDR A:0x60802fa4
y.create.l HWIO_QDSS_STMLAR_ADDR A:0x60802fb0
y.create.l HWIO_QDSS_STMLSR_ADDR A:0x60802fb4
y.create.l HWIO_QDSS_STMAUTHSTATUS_ADDR A:0x60802fb8
y.create.l HWIO_QDSS_STMDEVID_ADDR A:0x60802fc8
y.create.l HWIO_QDSS_STMDEVTYPE_ADDR A:0x60802fcc
y.create.l HWIO_QDSS_STMPIDR0_ADDR A:0x60802fe0
y.create.l HWIO_QDSS_STMPIDR1_ADDR A:0x60802fe4
y.create.l HWIO_QDSS_STMPIDR2_ADDR A:0x60802fe8
y.create.l HWIO_QDSS_STMPIDR3_ADDR A:0x60802fec
y.create.l HWIO_QDSS_STMPIDR4_ADDR A:0x60802fd0
y.create.l HWIO_QDSS_STMPIDR5_ADDR A:0x60802fd4
y.create.l HWIO_QDSS_STMPIDR6_ADDR A:0x60802fd8
y.create.l HWIO_QDSS_STMPIDR7_ADDR A:0x60802fdc
y.create.l HWIO_QDSS_STMCIDR0_ADDR A:0x60802ff0
y.create.l HWIO_QDSS_STMCIDR1_ADDR A:0x60802ff4
y.create.l HWIO_QDSS_STMCIDR2_ADDR A:0x60802ff8
y.create.l HWIO_QDSS_STMCIDR3_ADDR A:0x60802ffc
y.create.l HWIO_QDSS_CTI0_CTICONTROL_ADDR A:0x60810000
y.create.l HWIO_QDSS_CTI0_CTIINTACK_ADDR A:0x60810010
y.create.l HWIO_QDSS_CTI0_CTIAPPSET_ADDR A:0x60810014
y.create.l HWIO_QDSS_CTI0_CTIAPPCLEAR_ADDR A:0x60810018
y.create.l HWIO_QDSS_CTI0_CTIAPPPULSE_ADDR A:0x6081001c
y.create.l HWIO_QDSS_CTI0_CTIINEN0_ADDR A:0x60810020
y.create.l HWIO_QDSS_CTI0_CTIINEN1_ADDR A:0x60810024
y.create.l HWIO_QDSS_CTI0_CTIINEN2_ADDR A:0x60810028
y.create.l HWIO_QDSS_CTI0_CTIINEN3_ADDR A:0x6081002c
y.create.l HWIO_QDSS_CTI0_CTIINEN4_ADDR A:0x60810030
y.create.l HWIO_QDSS_CTI0_CTIINEN5_ADDR A:0x60810034
y.create.l HWIO_QDSS_CTI0_CTIINEN6_ADDR A:0x60810038
y.create.l HWIO_QDSS_CTI0_CTIINEN7_ADDR A:0x6081003c
y.create.l HWIO_QDSS_CTI0_CTIOUTEN0_ADDR A:0x608100a0
y.create.l HWIO_QDSS_CTI0_CTIOUTEN1_ADDR A:0x608100a4
y.create.l HWIO_QDSS_CTI0_CTIOUTEN2_ADDR A:0x608100a8
y.create.l HWIO_QDSS_CTI0_CTIOUTEN3_ADDR A:0x608100ac
y.create.l HWIO_QDSS_CTI0_CTIOUTEN4_ADDR A:0x608100b0
y.create.l HWIO_QDSS_CTI0_CTIOUTEN5_ADDR A:0x608100b4
y.create.l HWIO_QDSS_CTI0_CTIOUTEN6_ADDR A:0x608100b8
y.create.l HWIO_QDSS_CTI0_CTIOUTEN7_ADDR A:0x608100bc
y.create.l HWIO_QDSS_CTI0_CTITRIGINSTATUS_ADDR A:0x60810130
y.create.l HWIO_QDSS_CTI0_CTITRIGOUTSTATUS_ADDR A:0x60810134
y.create.l HWIO_QDSS_CTI0_CTICHINSTATUS_ADDR A:0x60810138
y.create.l HWIO_QDSS_CTI0_CTICHOUTSTATUS_ADDR A:0x6081013c
y.create.l HWIO_QDSS_CTI0_CTIGATE_ADDR A:0x60810140
y.create.l HWIO_QDSS_CTI0_ASICCTL_ADDR A:0x60810144
y.create.l HWIO_QDSS_CTI0_ITCHINACK_ADDR A:0x60810edc
y.create.l HWIO_QDSS_CTI0_ITTRIGINACK_ADDR A:0x60810ee0
y.create.l HWIO_QDSS_CTI0_ITCHOUT_ADDR A:0x60810ee4
y.create.l HWIO_QDSS_CTI0_ITTRIGOUT_ADDR A:0x60810ee8
y.create.l HWIO_QDSS_CTI0_ITCHOUTACK_ADDR A:0x60810eec
y.create.l HWIO_QDSS_CTI0_ITTRIGOUTACK_ADDR A:0x60810ef0
y.create.l HWIO_QDSS_CTI0_ITCHIN_ADDR A:0x60810ef4
y.create.l HWIO_QDSS_CTI0_ITTRIGIN_ADDR A:0x60810ef8
y.create.l HWIO_QDSS_CTI0_ITCTRL_ADDR A:0x60810f00
y.create.l HWIO_QDSS_CTI0_CLAIMSET_ADDR A:0x60810fa0
y.create.l HWIO_QDSS_CTI0_CLAIMCLR_ADDR A:0x60810fa4
y.create.l HWIO_QDSS_CTI0_LAR_ADDR A:0x60810fb0
y.create.l HWIO_QDSS_CTI0_LSR_ADDR A:0x60810fb4
y.create.l HWIO_QDSS_CTI0_AUTHSTATUS_ADDR A:0x60810fb8
y.create.l HWIO_QDSS_CTI0_DEVID_ADDR A:0x60810fc8
y.create.l HWIO_QDSS_CTI0_DEVTYPE_ADDR A:0x60810fcc
y.create.l HWIO_QDSS_CTI0_PERIPHID0_ADDR A:0x60810fe0
y.create.l HWIO_QDSS_CTI0_PERIPHID1_ADDR A:0x60810fe4
y.create.l HWIO_QDSS_CTI0_PERIPHID2_ADDR A:0x60810fe8
y.create.l HWIO_QDSS_CTI0_PERIPHID3_ADDR A:0x60810fec
y.create.l HWIO_QDSS_CTI0_PERIPHID4_ADDR A:0x60810fd0
y.create.l HWIO_QDSS_CTI0_PERIPHID5_ADDR A:0x60810fd4
y.create.l HWIO_QDSS_CTI0_PERIPHID6_ADDR A:0x60810fd8
y.create.l HWIO_QDSS_CTI0_PERIPHID7_ADDR A:0x60810fdc
y.create.l HWIO_QDSS_CTI0_COMPID0_ADDR A:0x60810ff0
y.create.l HWIO_QDSS_CTI0_COMPID1_ADDR A:0x60810ff4
y.create.l HWIO_QDSS_CTI0_COMPID2_ADDR A:0x60810ff8
y.create.l HWIO_QDSS_CTI0_COMPID3_ADDR A:0x60810ffc
y.create.l HWIO_QDSS_CTI1_CTICONTROL_ADDR A:0x60811000
y.create.l HWIO_QDSS_CTI1_CTIINTACK_ADDR A:0x60811010
y.create.l HWIO_QDSS_CTI1_CTIAPPSET_ADDR A:0x60811014
y.create.l HWIO_QDSS_CTI1_CTIAPPCLEAR_ADDR A:0x60811018
y.create.l HWIO_QDSS_CTI1_CTIAPPPULSE_ADDR A:0x6081101c
y.create.l HWIO_QDSS_CTI1_CTIINEN0_ADDR A:0x60811020
y.create.l HWIO_QDSS_CTI1_CTIINEN1_ADDR A:0x60811024
y.create.l HWIO_QDSS_CTI1_CTIINEN2_ADDR A:0x60811028
y.create.l HWIO_QDSS_CTI1_CTIINEN3_ADDR A:0x6081102c
y.create.l HWIO_QDSS_CTI1_CTIINEN4_ADDR A:0x60811030
y.create.l HWIO_QDSS_CTI1_CTIINEN5_ADDR A:0x60811034
y.create.l HWIO_QDSS_CTI1_CTIINEN6_ADDR A:0x60811038
y.create.l HWIO_QDSS_CTI1_CTIINEN7_ADDR A:0x6081103c
y.create.l HWIO_QDSS_CTI1_CTIOUTEN0_ADDR A:0x608110a0
y.create.l HWIO_QDSS_CTI1_CTIOUTEN1_ADDR A:0x608110a4
y.create.l HWIO_QDSS_CTI1_CTIOUTEN2_ADDR A:0x608110a8
y.create.l HWIO_QDSS_CTI1_CTIOUTEN3_ADDR A:0x608110ac
y.create.l HWIO_QDSS_CTI1_CTIOUTEN4_ADDR A:0x608110b0
y.create.l HWIO_QDSS_CTI1_CTIOUTEN5_ADDR A:0x608110b4
y.create.l HWIO_QDSS_CTI1_CTIOUTEN6_ADDR A:0x608110b8
y.create.l HWIO_QDSS_CTI1_CTIOUTEN7_ADDR A:0x608110bc
y.create.l HWIO_QDSS_CTI1_CTITRIGINSTATUS_ADDR A:0x60811130
y.create.l HWIO_QDSS_CTI1_CTITRIGOUTSTATUS_ADDR A:0x60811134
y.create.l HWIO_QDSS_CTI1_CTICHINSTATUS_ADDR A:0x60811138
y.create.l HWIO_QDSS_CTI1_CTICHOUTSTATUS_ADDR A:0x6081113c
y.create.l HWIO_QDSS_CTI1_CTIGATE_ADDR A:0x60811140
y.create.l HWIO_QDSS_CTI1_ASICCTL_ADDR A:0x60811144
y.create.l HWIO_QDSS_CTI1_ITCHINACK_ADDR A:0x60811edc
y.create.l HWIO_QDSS_CTI1_ITTRIGINACK_ADDR A:0x60811ee0
y.create.l HWIO_QDSS_CTI1_ITCHOUT_ADDR A:0x60811ee4
y.create.l HWIO_QDSS_CTI1_ITTRIGOUT_ADDR A:0x60811ee8
y.create.l HWIO_QDSS_CTI1_ITCHOUTACK_ADDR A:0x60811eec
y.create.l HWIO_QDSS_CTI1_ITTRIGOUTACK_ADDR A:0x60811ef0
y.create.l HWIO_QDSS_CTI1_ITCHIN_ADDR A:0x60811ef4
y.create.l HWIO_QDSS_CTI1_ITTRIGIN_ADDR A:0x60811ef8
y.create.l HWIO_QDSS_CTI1_ITCTRL_ADDR A:0x60811f00
y.create.l HWIO_QDSS_CTI1_CLAIMSET_ADDR A:0x60811fa0
y.create.l HWIO_QDSS_CTI1_CLAIMCLR_ADDR A:0x60811fa4
y.create.l HWIO_QDSS_CTI1_LAR_ADDR A:0x60811fb0
y.create.l HWIO_QDSS_CTI1_LSR_ADDR A:0x60811fb4
y.create.l HWIO_QDSS_CTI1_AUTHSTATUS_ADDR A:0x60811fb8
y.create.l HWIO_QDSS_CTI1_DEVID_ADDR A:0x60811fc8
y.create.l HWIO_QDSS_CTI1_DEVTYPE_ADDR A:0x60811fcc
y.create.l HWIO_QDSS_CTI1_PERIPHID0_ADDR A:0x60811fe0
y.create.l HWIO_QDSS_CTI1_PERIPHID1_ADDR A:0x60811fe4
y.create.l HWIO_QDSS_CTI1_PERIPHID2_ADDR A:0x60811fe8
y.create.l HWIO_QDSS_CTI1_PERIPHID3_ADDR A:0x60811fec
y.create.l HWIO_QDSS_CTI1_PERIPHID4_ADDR A:0x60811fd0
y.create.l HWIO_QDSS_CTI1_PERIPHID5_ADDR A:0x60811fd4
y.create.l HWIO_QDSS_CTI1_PERIPHID6_ADDR A:0x60811fd8
y.create.l HWIO_QDSS_CTI1_PERIPHID7_ADDR A:0x60811fdc
y.create.l HWIO_QDSS_CTI1_COMPID0_ADDR A:0x60811ff0
y.create.l HWIO_QDSS_CTI1_COMPID1_ADDR A:0x60811ff4
y.create.l HWIO_QDSS_CTI1_COMPID2_ADDR A:0x60811ff8
y.create.l HWIO_QDSS_CTI1_COMPID3_ADDR A:0x60811ffc
y.create.l HWIO_QDSS_CTI2_CTICONTROL_ADDR A:0x60812000
y.create.l HWIO_QDSS_CTI2_CTIINTACK_ADDR A:0x60812010
y.create.l HWIO_QDSS_CTI2_CTIAPPSET_ADDR A:0x60812014
y.create.l HWIO_QDSS_CTI2_CTIAPPCLEAR_ADDR A:0x60812018
y.create.l HWIO_QDSS_CTI2_CTIAPPPULSE_ADDR A:0x6081201c
y.create.l HWIO_QDSS_CTI2_CTIINEN0_ADDR A:0x60812020
y.create.l HWIO_QDSS_CTI2_CTIINEN1_ADDR A:0x60812024
y.create.l HWIO_QDSS_CTI2_CTIINEN2_ADDR A:0x60812028
y.create.l HWIO_QDSS_CTI2_CTIINEN3_ADDR A:0x6081202c
y.create.l HWIO_QDSS_CTI2_CTIINEN4_ADDR A:0x60812030
y.create.l HWIO_QDSS_CTI2_CTIINEN5_ADDR A:0x60812034
y.create.l HWIO_QDSS_CTI2_CTIINEN6_ADDR A:0x60812038
y.create.l HWIO_QDSS_CTI2_CTIINEN7_ADDR A:0x6081203c
y.create.l HWIO_QDSS_CTI2_CTIOUTEN0_ADDR A:0x608120a0
y.create.l HWIO_QDSS_CTI2_CTIOUTEN1_ADDR A:0x608120a4
y.create.l HWIO_QDSS_CTI2_CTIOUTEN2_ADDR A:0x608120a8
y.create.l HWIO_QDSS_CTI2_CTIOUTEN3_ADDR A:0x608120ac
y.create.l HWIO_QDSS_CTI2_CTIOUTEN4_ADDR A:0x608120b0
y.create.l HWIO_QDSS_CTI2_CTIOUTEN5_ADDR A:0x608120b4
y.create.l HWIO_QDSS_CTI2_CTIOUTEN6_ADDR A:0x608120b8
y.create.l HWIO_QDSS_CTI2_CTIOUTEN7_ADDR A:0x608120bc
y.create.l HWIO_QDSS_CTI2_CTITRIGINSTATUS_ADDR A:0x60812130
y.create.l HWIO_QDSS_CTI2_CTITRIGOUTSTATUS_ADDR A:0x60812134
y.create.l HWIO_QDSS_CTI2_CTICHINSTATUS_ADDR A:0x60812138
y.create.l HWIO_QDSS_CTI2_CTICHOUTSTATUS_ADDR A:0x6081213c
y.create.l HWIO_QDSS_CTI2_CTIGATE_ADDR A:0x60812140
y.create.l HWIO_QDSS_CTI2_ASICCTL_ADDR A:0x60812144
y.create.l HWIO_QDSS_CTI2_ITCHINACK_ADDR A:0x60812edc
y.create.l HWIO_QDSS_CTI2_ITTRIGINACK_ADDR A:0x60812ee0
y.create.l HWIO_QDSS_CTI2_ITCHOUT_ADDR A:0x60812ee4
y.create.l HWIO_QDSS_CTI2_ITTRIGOUT_ADDR A:0x60812ee8
y.create.l HWIO_QDSS_CTI2_ITCHOUTACK_ADDR A:0x60812eec
y.create.l HWIO_QDSS_CTI2_ITTRIGOUTACK_ADDR A:0x60812ef0
y.create.l HWIO_QDSS_CTI2_ITCHIN_ADDR A:0x60812ef4
y.create.l HWIO_QDSS_CTI2_ITTRIGIN_ADDR A:0x60812ef8
y.create.l HWIO_QDSS_CTI2_ITCTRL_ADDR A:0x60812f00
y.create.l HWIO_QDSS_CTI2_CLAIMSET_ADDR A:0x60812fa0
y.create.l HWIO_QDSS_CTI2_CLAIMCLR_ADDR A:0x60812fa4
y.create.l HWIO_QDSS_CTI2_LAR_ADDR A:0x60812fb0
y.create.l HWIO_QDSS_CTI2_LSR_ADDR A:0x60812fb4
y.create.l HWIO_QDSS_CTI2_AUTHSTATUS_ADDR A:0x60812fb8
y.create.l HWIO_QDSS_CTI2_DEVID_ADDR A:0x60812fc8
y.create.l HWIO_QDSS_CTI2_DEVTYPE_ADDR A:0x60812fcc
y.create.l HWIO_QDSS_CTI2_PERIPHID0_ADDR A:0x60812fe0
y.create.l HWIO_QDSS_CTI2_PERIPHID1_ADDR A:0x60812fe4
y.create.l HWIO_QDSS_CTI2_PERIPHID2_ADDR A:0x60812fe8
y.create.l HWIO_QDSS_CTI2_PERIPHID3_ADDR A:0x60812fec
y.create.l HWIO_QDSS_CTI2_PERIPHID4_ADDR A:0x60812fd0
y.create.l HWIO_QDSS_CTI2_PERIPHID5_ADDR A:0x60812fd4
y.create.l HWIO_QDSS_CTI2_PERIPHID6_ADDR A:0x60812fd8
y.create.l HWIO_QDSS_CTI2_PERIPHID7_ADDR A:0x60812fdc
y.create.l HWIO_QDSS_CTI2_COMPID0_ADDR A:0x60812ff0
y.create.l HWIO_QDSS_CTI2_COMPID1_ADDR A:0x60812ff4
y.create.l HWIO_QDSS_CTI2_COMPID2_ADDR A:0x60812ff8
y.create.l HWIO_QDSS_CTI2_COMPID3_ADDR A:0x60812ffc
y.create.l HWIO_QDSS_CTI3_CTICONTROL_ADDR A:0x60813000
y.create.l HWIO_QDSS_CTI3_CTIINTACK_ADDR A:0x60813010
y.create.l HWIO_QDSS_CTI3_CTIAPPSET_ADDR A:0x60813014
y.create.l HWIO_QDSS_CTI3_CTIAPPCLEAR_ADDR A:0x60813018
y.create.l HWIO_QDSS_CTI3_CTIAPPPULSE_ADDR A:0x6081301c
y.create.l HWIO_QDSS_CTI3_CTIINEN0_ADDR A:0x60813020
y.create.l HWIO_QDSS_CTI3_CTIINEN1_ADDR A:0x60813024
y.create.l HWIO_QDSS_CTI3_CTIINEN2_ADDR A:0x60813028
y.create.l HWIO_QDSS_CTI3_CTIINEN3_ADDR A:0x6081302c
y.create.l HWIO_QDSS_CTI3_CTIINEN4_ADDR A:0x60813030
y.create.l HWIO_QDSS_CTI3_CTIINEN5_ADDR A:0x60813034
y.create.l HWIO_QDSS_CTI3_CTIINEN6_ADDR A:0x60813038
y.create.l HWIO_QDSS_CTI3_CTIINEN7_ADDR A:0x6081303c
y.create.l HWIO_QDSS_CTI3_CTIOUTEN0_ADDR A:0x608130a0
y.create.l HWIO_QDSS_CTI3_CTIOUTEN1_ADDR A:0x608130a4
y.create.l HWIO_QDSS_CTI3_CTIOUTEN2_ADDR A:0x608130a8
y.create.l HWIO_QDSS_CTI3_CTIOUTEN3_ADDR A:0x608130ac
y.create.l HWIO_QDSS_CTI3_CTIOUTEN4_ADDR A:0x608130b0
y.create.l HWIO_QDSS_CTI3_CTIOUTEN5_ADDR A:0x608130b4
y.create.l HWIO_QDSS_CTI3_CTIOUTEN6_ADDR A:0x608130b8
y.create.l HWIO_QDSS_CTI3_CTIOUTEN7_ADDR A:0x608130bc
y.create.l HWIO_QDSS_CTI3_CTITRIGINSTATUS_ADDR A:0x60813130
y.create.l HWIO_QDSS_CTI3_CTITRIGOUTSTATUS_ADDR A:0x60813134
y.create.l HWIO_QDSS_CTI3_CTICHINSTATUS_ADDR A:0x60813138
y.create.l HWIO_QDSS_CTI3_CTICHOUTSTATUS_ADDR A:0x6081313c
y.create.l HWIO_QDSS_CTI3_CTIGATE_ADDR A:0x60813140
y.create.l HWIO_QDSS_CTI3_ASICCTL_ADDR A:0x60813144
y.create.l HWIO_QDSS_CTI3_ITCHINACK_ADDR A:0x60813edc
y.create.l HWIO_QDSS_CTI3_ITTRIGINACK_ADDR A:0x60813ee0
y.create.l HWIO_QDSS_CTI3_ITCHOUT_ADDR A:0x60813ee4
y.create.l HWIO_QDSS_CTI3_ITTRIGOUT_ADDR A:0x60813ee8
y.create.l HWIO_QDSS_CTI3_ITCHOUTACK_ADDR A:0x60813eec
y.create.l HWIO_QDSS_CTI3_ITTRIGOUTACK_ADDR A:0x60813ef0
y.create.l HWIO_QDSS_CTI3_ITCHIN_ADDR A:0x60813ef4
y.create.l HWIO_QDSS_CTI3_ITTRIGIN_ADDR A:0x60813ef8
y.create.l HWIO_QDSS_CTI3_ITCTRL_ADDR A:0x60813f00
y.create.l HWIO_QDSS_CTI3_CLAIMSET_ADDR A:0x60813fa0
y.create.l HWIO_QDSS_CTI3_CLAIMCLR_ADDR A:0x60813fa4
y.create.l HWIO_QDSS_CTI3_LAR_ADDR A:0x60813fb0
y.create.l HWIO_QDSS_CTI3_LSR_ADDR A:0x60813fb4
y.create.l HWIO_QDSS_CTI3_AUTHSTATUS_ADDR A:0x60813fb8
y.create.l HWIO_QDSS_CTI3_DEVID_ADDR A:0x60813fc8
y.create.l HWIO_QDSS_CTI3_DEVTYPE_ADDR A:0x60813fcc
y.create.l HWIO_QDSS_CTI3_PERIPHID0_ADDR A:0x60813fe0
y.create.l HWIO_QDSS_CTI3_PERIPHID1_ADDR A:0x60813fe4
y.create.l HWIO_QDSS_CTI3_PERIPHID2_ADDR A:0x60813fe8
y.create.l HWIO_QDSS_CTI3_PERIPHID3_ADDR A:0x60813fec
y.create.l HWIO_QDSS_CTI3_PERIPHID4_ADDR A:0x60813fd0
y.create.l HWIO_QDSS_CTI3_PERIPHID5_ADDR A:0x60813fd4
y.create.l HWIO_QDSS_CTI3_PERIPHID6_ADDR A:0x60813fd8
y.create.l HWIO_QDSS_CTI3_PERIPHID7_ADDR A:0x60813fdc
y.create.l HWIO_QDSS_CTI3_COMPID0_ADDR A:0x60813ff0
y.create.l HWIO_QDSS_CTI3_COMPID1_ADDR A:0x60813ff4
y.create.l HWIO_QDSS_CTI3_COMPID2_ADDR A:0x60813ff8
y.create.l HWIO_QDSS_CTI3_COMPID3_ADDR A:0x60813ffc
y.create.l HWIO_QDSS_CTI4_CTICONTROL_ADDR A:0x60814000
y.create.l HWIO_QDSS_CTI4_CTIINTACK_ADDR A:0x60814010
y.create.l HWIO_QDSS_CTI4_CTIAPPSET_ADDR A:0x60814014
y.create.l HWIO_QDSS_CTI4_CTIAPPCLEAR_ADDR A:0x60814018
y.create.l HWIO_QDSS_CTI4_CTIAPPPULSE_ADDR A:0x6081401c
y.create.l HWIO_QDSS_CTI4_CTIINEN0_ADDR A:0x60814020
y.create.l HWIO_QDSS_CTI4_CTIINEN1_ADDR A:0x60814024
y.create.l HWIO_QDSS_CTI4_CTIINEN2_ADDR A:0x60814028
y.create.l HWIO_QDSS_CTI4_CTIINEN3_ADDR A:0x6081402c
y.create.l HWIO_QDSS_CTI4_CTIINEN4_ADDR A:0x60814030
y.create.l HWIO_QDSS_CTI4_CTIINEN5_ADDR A:0x60814034
y.create.l HWIO_QDSS_CTI4_CTIINEN6_ADDR A:0x60814038
y.create.l HWIO_QDSS_CTI4_CTIINEN7_ADDR A:0x6081403c
y.create.l HWIO_QDSS_CTI4_CTIOUTEN0_ADDR A:0x608140a0
y.create.l HWIO_QDSS_CTI4_CTIOUTEN1_ADDR A:0x608140a4
y.create.l HWIO_QDSS_CTI4_CTIOUTEN2_ADDR A:0x608140a8
y.create.l HWIO_QDSS_CTI4_CTIOUTEN3_ADDR A:0x608140ac
y.create.l HWIO_QDSS_CTI4_CTIOUTEN4_ADDR A:0x608140b0
y.create.l HWIO_QDSS_CTI4_CTIOUTEN5_ADDR A:0x608140b4
y.create.l HWIO_QDSS_CTI4_CTIOUTEN6_ADDR A:0x608140b8
y.create.l HWIO_QDSS_CTI4_CTIOUTEN7_ADDR A:0x608140bc
y.create.l HWIO_QDSS_CTI4_CTITRIGINSTATUS_ADDR A:0x60814130
y.create.l HWIO_QDSS_CTI4_CTITRIGOUTSTATUS_ADDR A:0x60814134
y.create.l HWIO_QDSS_CTI4_CTICHINSTATUS_ADDR A:0x60814138
y.create.l HWIO_QDSS_CTI4_CTICHOUTSTATUS_ADDR A:0x6081413c
y.create.l HWIO_QDSS_CTI4_CTIGATE_ADDR A:0x60814140
y.create.l HWIO_QDSS_CTI4_ASICCTL_ADDR A:0x60814144
y.create.l HWIO_QDSS_CTI4_ITCHINACK_ADDR A:0x60814edc
y.create.l HWIO_QDSS_CTI4_ITTRIGINACK_ADDR A:0x60814ee0
y.create.l HWIO_QDSS_CTI4_ITCHOUT_ADDR A:0x60814ee4
y.create.l HWIO_QDSS_CTI4_ITTRIGOUT_ADDR A:0x60814ee8
y.create.l HWIO_QDSS_CTI4_ITCHOUTACK_ADDR A:0x60814eec
y.create.l HWIO_QDSS_CTI4_ITTRIGOUTACK_ADDR A:0x60814ef0
y.create.l HWIO_QDSS_CTI4_ITCHIN_ADDR A:0x60814ef4
y.create.l HWIO_QDSS_CTI4_ITTRIGIN_ADDR A:0x60814ef8
y.create.l HWIO_QDSS_CTI4_ITCTRL_ADDR A:0x60814f00
y.create.l HWIO_QDSS_CTI4_CLAIMSET_ADDR A:0x60814fa0
y.create.l HWIO_QDSS_CTI4_CLAIMCLR_ADDR A:0x60814fa4
y.create.l HWIO_QDSS_CTI4_LAR_ADDR A:0x60814fb0
y.create.l HWIO_QDSS_CTI4_LSR_ADDR A:0x60814fb4
y.create.l HWIO_QDSS_CTI4_AUTHSTATUS_ADDR A:0x60814fb8
y.create.l HWIO_QDSS_CTI4_DEVID_ADDR A:0x60814fc8
y.create.l HWIO_QDSS_CTI4_DEVTYPE_ADDR A:0x60814fcc
y.create.l HWIO_QDSS_CTI4_PERIPHID0_ADDR A:0x60814fe0
y.create.l HWIO_QDSS_CTI4_PERIPHID1_ADDR A:0x60814fe4
y.create.l HWIO_QDSS_CTI4_PERIPHID2_ADDR A:0x60814fe8
y.create.l HWIO_QDSS_CTI4_PERIPHID3_ADDR A:0x60814fec
y.create.l HWIO_QDSS_CTI4_PERIPHID4_ADDR A:0x60814fd0
y.create.l HWIO_QDSS_CTI4_PERIPHID5_ADDR A:0x60814fd4
y.create.l HWIO_QDSS_CTI4_PERIPHID6_ADDR A:0x60814fd8
y.create.l HWIO_QDSS_CTI4_PERIPHID7_ADDR A:0x60814fdc
y.create.l HWIO_QDSS_CTI4_COMPID0_ADDR A:0x60814ff0
y.create.l HWIO_QDSS_CTI4_COMPID1_ADDR A:0x60814ff4
y.create.l HWIO_QDSS_CTI4_COMPID2_ADDR A:0x60814ff8
y.create.l HWIO_QDSS_CTI4_COMPID3_ADDR A:0x60814ffc
y.create.l HWIO_QDSS_CTI5_CTICONTROL_ADDR A:0x60815000
y.create.l HWIO_QDSS_CTI5_CTIINTACK_ADDR A:0x60815010
y.create.l HWIO_QDSS_CTI5_CTIAPPSET_ADDR A:0x60815014
y.create.l HWIO_QDSS_CTI5_CTIAPPCLEAR_ADDR A:0x60815018
y.create.l HWIO_QDSS_CTI5_CTIAPPPULSE_ADDR A:0x6081501c
y.create.l HWIO_QDSS_CTI5_CTIINEN0_ADDR A:0x60815020
y.create.l HWIO_QDSS_CTI5_CTIINEN1_ADDR A:0x60815024
y.create.l HWIO_QDSS_CTI5_CTIINEN2_ADDR A:0x60815028
y.create.l HWIO_QDSS_CTI5_CTIINEN3_ADDR A:0x6081502c
y.create.l HWIO_QDSS_CTI5_CTIINEN4_ADDR A:0x60815030
y.create.l HWIO_QDSS_CTI5_CTIINEN5_ADDR A:0x60815034
y.create.l HWIO_QDSS_CTI5_CTIINEN6_ADDR A:0x60815038
y.create.l HWIO_QDSS_CTI5_CTIINEN7_ADDR A:0x6081503c
y.create.l HWIO_QDSS_CTI5_CTIOUTEN0_ADDR A:0x608150a0
y.create.l HWIO_QDSS_CTI5_CTIOUTEN1_ADDR A:0x608150a4
y.create.l HWIO_QDSS_CTI5_CTIOUTEN2_ADDR A:0x608150a8
y.create.l HWIO_QDSS_CTI5_CTIOUTEN3_ADDR A:0x608150ac
y.create.l HWIO_QDSS_CTI5_CTIOUTEN4_ADDR A:0x608150b0
y.create.l HWIO_QDSS_CTI5_CTIOUTEN5_ADDR A:0x608150b4
y.create.l HWIO_QDSS_CTI5_CTIOUTEN6_ADDR A:0x608150b8
y.create.l HWIO_QDSS_CTI5_CTIOUTEN7_ADDR A:0x608150bc
y.create.l HWIO_QDSS_CTI5_CTITRIGINSTATUS_ADDR A:0x60815130
y.create.l HWIO_QDSS_CTI5_CTITRIGOUTSTATUS_ADDR A:0x60815134
y.create.l HWIO_QDSS_CTI5_CTICHINSTATUS_ADDR A:0x60815138
y.create.l HWIO_QDSS_CTI5_CTICHOUTSTATUS_ADDR A:0x6081513c
y.create.l HWIO_QDSS_CTI5_CTIGATE_ADDR A:0x60815140
y.create.l HWIO_QDSS_CTI5_ASICCTL_ADDR A:0x60815144
y.create.l HWIO_QDSS_CTI5_ITCHINACK_ADDR A:0x60815edc
y.create.l HWIO_QDSS_CTI5_ITTRIGINACK_ADDR A:0x60815ee0
y.create.l HWIO_QDSS_CTI5_ITCHOUT_ADDR A:0x60815ee4
y.create.l HWIO_QDSS_CTI5_ITTRIGOUT_ADDR A:0x60815ee8
y.create.l HWIO_QDSS_CTI5_ITCHOUTACK_ADDR A:0x60815eec
y.create.l HWIO_QDSS_CTI5_ITTRIGOUTACK_ADDR A:0x60815ef0
y.create.l HWIO_QDSS_CTI5_ITCHIN_ADDR A:0x60815ef4
y.create.l HWIO_QDSS_CTI5_ITTRIGIN_ADDR A:0x60815ef8
y.create.l HWIO_QDSS_CTI5_ITCTRL_ADDR A:0x60815f00
y.create.l HWIO_QDSS_CTI5_CLAIMSET_ADDR A:0x60815fa0
y.create.l HWIO_QDSS_CTI5_CLAIMCLR_ADDR A:0x60815fa4
y.create.l HWIO_QDSS_CTI5_LAR_ADDR A:0x60815fb0
y.create.l HWIO_QDSS_CTI5_LSR_ADDR A:0x60815fb4
y.create.l HWIO_QDSS_CTI5_AUTHSTATUS_ADDR A:0x60815fb8
y.create.l HWIO_QDSS_CTI5_DEVID_ADDR A:0x60815fc8
y.create.l HWIO_QDSS_CTI5_DEVTYPE_ADDR A:0x60815fcc
y.create.l HWIO_QDSS_CTI5_PERIPHID0_ADDR A:0x60815fe0
y.create.l HWIO_QDSS_CTI5_PERIPHID1_ADDR A:0x60815fe4
y.create.l HWIO_QDSS_CTI5_PERIPHID2_ADDR A:0x60815fe8
y.create.l HWIO_QDSS_CTI5_PERIPHID3_ADDR A:0x60815fec
y.create.l HWIO_QDSS_CTI5_PERIPHID4_ADDR A:0x60815fd0
y.create.l HWIO_QDSS_CTI5_PERIPHID5_ADDR A:0x60815fd4
y.create.l HWIO_QDSS_CTI5_PERIPHID6_ADDR A:0x60815fd8
y.create.l HWIO_QDSS_CTI5_PERIPHID7_ADDR A:0x60815fdc
y.create.l HWIO_QDSS_CTI5_COMPID0_ADDR A:0x60815ff0
y.create.l HWIO_QDSS_CTI5_COMPID1_ADDR A:0x60815ff4
y.create.l HWIO_QDSS_CTI5_COMPID2_ADDR A:0x60815ff8
y.create.l HWIO_QDSS_CTI5_COMPID3_ADDR A:0x60815ffc
y.create.l HWIO_QDSS_CTI6_CTICONTROL_ADDR A:0x60816000
y.create.l HWIO_QDSS_CTI6_CTIINTACK_ADDR A:0x60816010
y.create.l HWIO_QDSS_CTI6_CTIAPPSET_ADDR A:0x60816014
y.create.l HWIO_QDSS_CTI6_CTIAPPCLEAR_ADDR A:0x60816018
y.create.l HWIO_QDSS_CTI6_CTIAPPPULSE_ADDR A:0x6081601c
y.create.l HWIO_QDSS_CTI6_CTIINEN0_ADDR A:0x60816020
y.create.l HWIO_QDSS_CTI6_CTIINEN1_ADDR A:0x60816024
y.create.l HWIO_QDSS_CTI6_CTIINEN2_ADDR A:0x60816028
y.create.l HWIO_QDSS_CTI6_CTIINEN3_ADDR A:0x6081602c
y.create.l HWIO_QDSS_CTI6_CTIINEN4_ADDR A:0x60816030
y.create.l HWIO_QDSS_CTI6_CTIINEN5_ADDR A:0x60816034
y.create.l HWIO_QDSS_CTI6_CTIINEN6_ADDR A:0x60816038
y.create.l HWIO_QDSS_CTI6_CTIINEN7_ADDR A:0x6081603c
y.create.l HWIO_QDSS_CTI6_CTIOUTEN0_ADDR A:0x608160a0
y.create.l HWIO_QDSS_CTI6_CTIOUTEN1_ADDR A:0x608160a4
y.create.l HWIO_QDSS_CTI6_CTIOUTEN2_ADDR A:0x608160a8
y.create.l HWIO_QDSS_CTI6_CTIOUTEN3_ADDR A:0x608160ac
y.create.l HWIO_QDSS_CTI6_CTIOUTEN4_ADDR A:0x608160b0
y.create.l HWIO_QDSS_CTI6_CTIOUTEN5_ADDR A:0x608160b4
y.create.l HWIO_QDSS_CTI6_CTIOUTEN6_ADDR A:0x608160b8
y.create.l HWIO_QDSS_CTI6_CTIOUTEN7_ADDR A:0x608160bc
y.create.l HWIO_QDSS_CTI6_CTITRIGINSTATUS_ADDR A:0x60816130
y.create.l HWIO_QDSS_CTI6_CTITRIGOUTSTATUS_ADDR A:0x60816134
y.create.l HWIO_QDSS_CTI6_CTICHINSTATUS_ADDR A:0x60816138
y.create.l HWIO_QDSS_CTI6_CTICHOUTSTATUS_ADDR A:0x6081613c
y.create.l HWIO_QDSS_CTI6_CTIGATE_ADDR A:0x60816140
y.create.l HWIO_QDSS_CTI6_ASICCTL_ADDR A:0x60816144
y.create.l HWIO_QDSS_CTI6_ITCHINACK_ADDR A:0x60816edc
y.create.l HWIO_QDSS_CTI6_ITTRIGINACK_ADDR A:0x60816ee0
y.create.l HWIO_QDSS_CTI6_ITCHOUT_ADDR A:0x60816ee4
y.create.l HWIO_QDSS_CTI6_ITTRIGOUT_ADDR A:0x60816ee8
y.create.l HWIO_QDSS_CTI6_ITCHOUTACK_ADDR A:0x60816eec
y.create.l HWIO_QDSS_CTI6_ITTRIGOUTACK_ADDR A:0x60816ef0
y.create.l HWIO_QDSS_CTI6_ITCHIN_ADDR A:0x60816ef4
y.create.l HWIO_QDSS_CTI6_ITTRIGIN_ADDR A:0x60816ef8
y.create.l HWIO_QDSS_CTI6_ITCTRL_ADDR A:0x60816f00
y.create.l HWIO_QDSS_CTI6_CLAIMSET_ADDR A:0x60816fa0
y.create.l HWIO_QDSS_CTI6_CLAIMCLR_ADDR A:0x60816fa4
y.create.l HWIO_QDSS_CTI6_LAR_ADDR A:0x60816fb0
y.create.l HWIO_QDSS_CTI6_LSR_ADDR A:0x60816fb4
y.create.l HWIO_QDSS_CTI6_AUTHSTATUS_ADDR A:0x60816fb8
y.create.l HWIO_QDSS_CTI6_DEVID_ADDR A:0x60816fc8
y.create.l HWIO_QDSS_CTI6_DEVTYPE_ADDR A:0x60816fcc
y.create.l HWIO_QDSS_CTI6_PERIPHID0_ADDR A:0x60816fe0
y.create.l HWIO_QDSS_CTI6_PERIPHID1_ADDR A:0x60816fe4
y.create.l HWIO_QDSS_CTI6_PERIPHID2_ADDR A:0x60816fe8
y.create.l HWIO_QDSS_CTI6_PERIPHID3_ADDR A:0x60816fec
y.create.l HWIO_QDSS_CTI6_PERIPHID4_ADDR A:0x60816fd0
y.create.l HWIO_QDSS_CTI6_PERIPHID5_ADDR A:0x60816fd4
y.create.l HWIO_QDSS_CTI6_PERIPHID6_ADDR A:0x60816fd8
y.create.l HWIO_QDSS_CTI6_PERIPHID7_ADDR A:0x60816fdc
y.create.l HWIO_QDSS_CTI6_COMPID0_ADDR A:0x60816ff0
y.create.l HWIO_QDSS_CTI6_COMPID1_ADDR A:0x60816ff4
y.create.l HWIO_QDSS_CTI6_COMPID2_ADDR A:0x60816ff8
y.create.l HWIO_QDSS_CTI6_COMPID3_ADDR A:0x60816ffc
y.create.l HWIO_QDSS_CTI7_CTICONTROL_ADDR A:0x60817000
y.create.l HWIO_QDSS_CTI7_CTIINTACK_ADDR A:0x60817010
y.create.l HWIO_QDSS_CTI7_CTIAPPSET_ADDR A:0x60817014
y.create.l HWIO_QDSS_CTI7_CTIAPPCLEAR_ADDR A:0x60817018
y.create.l HWIO_QDSS_CTI7_CTIAPPPULSE_ADDR A:0x6081701c
y.create.l HWIO_QDSS_CTI7_CTIINEN0_ADDR A:0x60817020
y.create.l HWIO_QDSS_CTI7_CTIINEN1_ADDR A:0x60817024
y.create.l HWIO_QDSS_CTI7_CTIINEN2_ADDR A:0x60817028
y.create.l HWIO_QDSS_CTI7_CTIINEN3_ADDR A:0x6081702c
y.create.l HWIO_QDSS_CTI7_CTIINEN4_ADDR A:0x60817030
y.create.l HWIO_QDSS_CTI7_CTIINEN5_ADDR A:0x60817034
y.create.l HWIO_QDSS_CTI7_CTIINEN6_ADDR A:0x60817038
y.create.l HWIO_QDSS_CTI7_CTIINEN7_ADDR A:0x6081703c
y.create.l HWIO_QDSS_CTI7_CTIOUTEN0_ADDR A:0x608170a0
y.create.l HWIO_QDSS_CTI7_CTIOUTEN1_ADDR A:0x608170a4
y.create.l HWIO_QDSS_CTI7_CTIOUTEN2_ADDR A:0x608170a8
y.create.l HWIO_QDSS_CTI7_CTIOUTEN3_ADDR A:0x608170ac
y.create.l HWIO_QDSS_CTI7_CTIOUTEN4_ADDR A:0x608170b0
y.create.l HWIO_QDSS_CTI7_CTIOUTEN5_ADDR A:0x608170b4
y.create.l HWIO_QDSS_CTI7_CTIOUTEN6_ADDR A:0x608170b8
y.create.l HWIO_QDSS_CTI7_CTIOUTEN7_ADDR A:0x608170bc
y.create.l HWIO_QDSS_CTI7_CTITRIGINSTATUS_ADDR A:0x60817130
y.create.l HWIO_QDSS_CTI7_CTITRIGOUTSTATUS_ADDR A:0x60817134
y.create.l HWIO_QDSS_CTI7_CTICHINSTATUS_ADDR A:0x60817138
y.create.l HWIO_QDSS_CTI7_CTICHOUTSTATUS_ADDR A:0x6081713c
y.create.l HWIO_QDSS_CTI7_CTIGATE_ADDR A:0x60817140
y.create.l HWIO_QDSS_CTI7_ASICCTL_ADDR A:0x60817144
y.create.l HWIO_QDSS_CTI7_ITCHINACK_ADDR A:0x60817edc
y.create.l HWIO_QDSS_CTI7_ITTRIGINACK_ADDR A:0x60817ee0
y.create.l HWIO_QDSS_CTI7_ITCHOUT_ADDR A:0x60817ee4
y.create.l HWIO_QDSS_CTI7_ITTRIGOUT_ADDR A:0x60817ee8
y.create.l HWIO_QDSS_CTI7_ITCHOUTACK_ADDR A:0x60817eec
y.create.l HWIO_QDSS_CTI7_ITTRIGOUTACK_ADDR A:0x60817ef0
y.create.l HWIO_QDSS_CTI7_ITCHIN_ADDR A:0x60817ef4
y.create.l HWIO_QDSS_CTI7_ITTRIGIN_ADDR A:0x60817ef8
y.create.l HWIO_QDSS_CTI7_ITCTRL_ADDR A:0x60817f00
y.create.l HWIO_QDSS_CTI7_CLAIMSET_ADDR A:0x60817fa0
y.create.l HWIO_QDSS_CTI7_CLAIMCLR_ADDR A:0x60817fa4
y.create.l HWIO_QDSS_CTI7_LAR_ADDR A:0x60817fb0
y.create.l HWIO_QDSS_CTI7_LSR_ADDR A:0x60817fb4
y.create.l HWIO_QDSS_CTI7_AUTHSTATUS_ADDR A:0x60817fb8
y.create.l HWIO_QDSS_CTI7_DEVID_ADDR A:0x60817fc8
y.create.l HWIO_QDSS_CTI7_DEVTYPE_ADDR A:0x60817fcc
y.create.l HWIO_QDSS_CTI7_PERIPHID0_ADDR A:0x60817fe0
y.create.l HWIO_QDSS_CTI7_PERIPHID1_ADDR A:0x60817fe4
y.create.l HWIO_QDSS_CTI7_PERIPHID2_ADDR A:0x60817fe8
y.create.l HWIO_QDSS_CTI7_PERIPHID3_ADDR A:0x60817fec
y.create.l HWIO_QDSS_CTI7_PERIPHID4_ADDR A:0x60817fd0
y.create.l HWIO_QDSS_CTI7_PERIPHID5_ADDR A:0x60817fd4
y.create.l HWIO_QDSS_CTI7_PERIPHID6_ADDR A:0x60817fd8
y.create.l HWIO_QDSS_CTI7_PERIPHID7_ADDR A:0x60817fdc
y.create.l HWIO_QDSS_CTI7_COMPID0_ADDR A:0x60817ff0
y.create.l HWIO_QDSS_CTI7_COMPID1_ADDR A:0x60817ff4
y.create.l HWIO_QDSS_CTI7_COMPID2_ADDR A:0x60817ff8
y.create.l HWIO_QDSS_CTI7_COMPID3_ADDR A:0x60817ffc
y.create.l HWIO_QDSS_CTI8_CTICONTROL_ADDR A:0x60818000
y.create.l HWIO_QDSS_CTI8_CTIINTACK_ADDR A:0x60818010
y.create.l HWIO_QDSS_CTI8_CTIAPPSET_ADDR A:0x60818014
y.create.l HWIO_QDSS_CTI8_CTIAPPCLEAR_ADDR A:0x60818018
y.create.l HWIO_QDSS_CTI8_CTIAPPPULSE_ADDR A:0x6081801c
y.create.l HWIO_QDSS_CTI8_CTIINEN0_ADDR A:0x60818020
y.create.l HWIO_QDSS_CTI8_CTIINEN1_ADDR A:0x60818024
y.create.l HWIO_QDSS_CTI8_CTIINEN2_ADDR A:0x60818028
y.create.l HWIO_QDSS_CTI8_CTIINEN3_ADDR A:0x6081802c
y.create.l HWIO_QDSS_CTI8_CTIINEN4_ADDR A:0x60818030
y.create.l HWIO_QDSS_CTI8_CTIINEN5_ADDR A:0x60818034
y.create.l HWIO_QDSS_CTI8_CTIINEN6_ADDR A:0x60818038
y.create.l HWIO_QDSS_CTI8_CTIINEN7_ADDR A:0x6081803c
y.create.l HWIO_QDSS_CTI8_CTIOUTEN0_ADDR A:0x608180a0
y.create.l HWIO_QDSS_CTI8_CTIOUTEN1_ADDR A:0x608180a4
y.create.l HWIO_QDSS_CTI8_CTIOUTEN2_ADDR A:0x608180a8
y.create.l HWIO_QDSS_CTI8_CTIOUTEN3_ADDR A:0x608180ac
y.create.l HWIO_QDSS_CTI8_CTIOUTEN4_ADDR A:0x608180b0
y.create.l HWIO_QDSS_CTI8_CTIOUTEN5_ADDR A:0x608180b4
y.create.l HWIO_QDSS_CTI8_CTIOUTEN6_ADDR A:0x608180b8
y.create.l HWIO_QDSS_CTI8_CTIOUTEN7_ADDR A:0x608180bc
y.create.l HWIO_QDSS_CTI8_CTITRIGINSTATUS_ADDR A:0x60818130
y.create.l HWIO_QDSS_CTI8_CTITRIGOUTSTATUS_ADDR A:0x60818134
y.create.l HWIO_QDSS_CTI8_CTICHINSTATUS_ADDR A:0x60818138
y.create.l HWIO_QDSS_CTI8_CTICHOUTSTATUS_ADDR A:0x6081813c
y.create.l HWIO_QDSS_CTI8_CTIGATE_ADDR A:0x60818140
y.create.l HWIO_QDSS_CTI8_ASICCTL_ADDR A:0x60818144
y.create.l HWIO_QDSS_CTI8_ITCHINACK_ADDR A:0x60818edc
y.create.l HWIO_QDSS_CTI8_ITTRIGINACK_ADDR A:0x60818ee0
y.create.l HWIO_QDSS_CTI8_ITCHOUT_ADDR A:0x60818ee4
y.create.l HWIO_QDSS_CTI8_ITTRIGOUT_ADDR A:0x60818ee8
y.create.l HWIO_QDSS_CTI8_ITCHOUTACK_ADDR A:0x60818eec
y.create.l HWIO_QDSS_CTI8_ITTRIGOUTACK_ADDR A:0x60818ef0
y.create.l HWIO_QDSS_CTI8_ITCHIN_ADDR A:0x60818ef4
y.create.l HWIO_QDSS_CTI8_ITTRIGIN_ADDR A:0x60818ef8
y.create.l HWIO_QDSS_CTI8_ITCTRL_ADDR A:0x60818f00
y.create.l HWIO_QDSS_CTI8_CLAIMSET_ADDR A:0x60818fa0
y.create.l HWIO_QDSS_CTI8_CLAIMCLR_ADDR A:0x60818fa4
y.create.l HWIO_QDSS_CTI8_LAR_ADDR A:0x60818fb0
y.create.l HWIO_QDSS_CTI8_LSR_ADDR A:0x60818fb4
y.create.l HWIO_QDSS_CTI8_AUTHSTATUS_ADDR A:0x60818fb8
y.create.l HWIO_QDSS_CTI8_DEVID_ADDR A:0x60818fc8
y.create.l HWIO_QDSS_CTI8_DEVTYPE_ADDR A:0x60818fcc
y.create.l HWIO_QDSS_CTI8_PERIPHID0_ADDR A:0x60818fe0
y.create.l HWIO_QDSS_CTI8_PERIPHID1_ADDR A:0x60818fe4
y.create.l HWIO_QDSS_CTI8_PERIPHID2_ADDR A:0x60818fe8
y.create.l HWIO_QDSS_CTI8_PERIPHID3_ADDR A:0x60818fec
y.create.l HWIO_QDSS_CTI8_PERIPHID4_ADDR A:0x60818fd0
y.create.l HWIO_QDSS_CTI8_PERIPHID5_ADDR A:0x60818fd4
y.create.l HWIO_QDSS_CTI8_PERIPHID6_ADDR A:0x60818fd8
y.create.l HWIO_QDSS_CTI8_PERIPHID7_ADDR A:0x60818fdc
y.create.l HWIO_QDSS_CTI8_COMPID0_ADDR A:0x60818ff0
y.create.l HWIO_QDSS_CTI8_COMPID1_ADDR A:0x60818ff4
y.create.l HWIO_QDSS_CTI8_COMPID2_ADDR A:0x60818ff8
y.create.l HWIO_QDSS_CTI8_COMPID3_ADDR A:0x60818ffc
y.create.l HWIO_QDSS_CSTPIU_SUPPORTED_PORT_SIZES_ADDR A:0x60820000
y.create.l HWIO_QDSS_CSTPIU_CURRENT_PORT_SIZE_ADDR A:0x60820004
y.create.l HWIO_QDSS_CSTPIU_SUPPORTED_TRIGGER_MODES_ADDR A:0x60820100
y.create.l HWIO_QDSS_CSTPIU_TRIGGER_COUNTER_VALUE_ADDR A:0x60820104
y.create.l HWIO_QDSS_CSTPIU_TRIGGER_MULTIPLIER_ADDR A:0x60820108
y.create.l HWIO_QDSS_CSTPIU_SUPPORTED_TEST_PATTERN_MODES_ADDR A:0x60820200
y.create.l HWIO_QDSS_CSTPIU_CURRENT_TEST_PATTERN_MODE_ADDR A:0x60820204
y.create.l HWIO_QDSS_CSTPIU_TPRCR_ADDR A:0x60820208
y.create.l HWIO_QDSS_CSTPIU_FFSR_ADDR A:0x60820300
y.create.l HWIO_QDSS_CSTPIU_FFCR_ADDR A:0x60820304
y.create.l HWIO_QDSS_CSTPIU_FSCR_ADDR A:0x60820308
y.create.l HWIO_QDSS_CSTPIU_EXTCTL_IN_PORT_ADDR A:0x60820400
y.create.l HWIO_QDSS_CSTPIU_EXTCTL_OUT_PORT_ADDR A:0x60820404
y.create.l HWIO_QDSS_CSTPIU_ITTRFLINACK_ADDR A:0x60820ee4
y.create.l HWIO_QDSS_CSTPIU_ITTRFLIN_ADDR A:0x60820ee8
y.create.l HWIO_QDSS_CSTPIU_ITATBDATA0_ADDR A:0x60820eec
y.create.l HWIO_QDSS_CSTPIU_ITATBCTR2_ADDR A:0x60820ef0
y.create.l HWIO_QDSS_CSTPIU_ITATBCTR1_ADDR A:0x60820ef4
y.create.l HWIO_QDSS_CSTPIU_ITATBCTR0_ADDR A:0x60820ef8
y.create.l HWIO_QDSS_CSTPIU_ITCTRL_ADDR A:0x60820f00
y.create.l HWIO_QDSS_CSTPIU_CLAIMSET_ADDR A:0x60820fa0
y.create.l HWIO_QDSS_CSTPIU_CLAIMCLR_ADDR A:0x60820fa4
y.create.l HWIO_QDSS_CSTPIU_LAR_ADDR A:0x60820fb0
y.create.l HWIO_QDSS_CSTPIU_LSR_ADDR A:0x60820fb4
y.create.l HWIO_QDSS_CSTPIU_AUTHSTATUS_ADDR A:0x60820fb8
y.create.l HWIO_QDSS_CSTPIU_DEVID_ADDR A:0x60820fc8
y.create.l HWIO_QDSS_CSTPIU_DEVTYPE_ADDR A:0x60820fcc
y.create.l HWIO_QDSS_CSTPIU_PERIPHID0_ADDR A:0x60820fe0
y.create.l HWIO_QDSS_CSTPIU_PERIPHID1_ADDR A:0x60820fe4
y.create.l HWIO_QDSS_CSTPIU_PERIPHID2_ADDR A:0x60820fe8
y.create.l HWIO_QDSS_CSTPIU_PERIPHID3_ADDR A:0x60820fec
y.create.l HWIO_QDSS_CSTPIU_PERIPHID4_ADDR A:0x60820fd0
y.create.l HWIO_QDSS_CSTPIU_PERIPHID5_ADDR A:0x60820fd4
y.create.l HWIO_QDSS_CSTPIU_PERIPHID6_ADDR A:0x60820fd8
y.create.l HWIO_QDSS_CSTPIU_PERIPHID7_ADDR A:0x60820fdc
y.create.l HWIO_QDSS_CSTPIU_COMPID0_ADDR A:0x60820ff0
y.create.l HWIO_QDSS_CSTPIU_COMPID1_ADDR A:0x60820ff4
y.create.l HWIO_QDSS_CSTPIU_COMPID2_ADDR A:0x60820ff8
y.create.l HWIO_QDSS_CSTPIU_COMPID3_ADDR A:0x60820ffc
y.create.l HWIO_QDSS_IN_FUN0_CTRL_REG_ADDR A:0x60821000
y.create.l HWIO_QDSS_IN_FUN0_PRIORITY_CTRL_REG_ADDR A:0x60821004
y.create.l HWIO_QDSS_IN_FUN0_ITATBDATA0_ADDR A:0x60821eec
y.create.l HWIO_QDSS_IN_FUN0_ITATBCTR2_ADDR A:0x60821ef0
y.create.l HWIO_QDSS_IN_FUN0_ITATBCTR1_ADDR A:0x60821ef4
y.create.l HWIO_QDSS_IN_FUN0_ITATBCTR0_ADDR A:0x60821ef8
y.create.l HWIO_QDSS_IN_FUN0_ITCTRL_ADDR A:0x60821f00
y.create.l HWIO_QDSS_IN_FUN0_CLAIMSET_ADDR A:0x60821fa0
y.create.l HWIO_QDSS_IN_FUN0_CLAIMCLR_ADDR A:0x60821fa4
y.create.l HWIO_QDSS_IN_FUN0_LOCKACCESS_ADDR A:0x60821fb0
y.create.l HWIO_QDSS_IN_FUN0_LOCKSTATUS_ADDR A:0x60821fb4
y.create.l HWIO_QDSS_IN_FUN0_AUTHSTATUS_ADDR A:0x60821fb8
y.create.l HWIO_QDSS_IN_FUN0_DEVID_ADDR A:0x60821fc8
y.create.l HWIO_QDSS_IN_FUN0_DEVTYPE_ADDR A:0x60821fcc
y.create.l HWIO_QDSS_IN_FUN0_PERIPHID0_ADDR A:0x60821fe0
y.create.l HWIO_QDSS_IN_FUN0_PERIPHID1_ADDR A:0x60821fe4
y.create.l HWIO_QDSS_IN_FUN0_PERIPHID2_ADDR A:0x60821fe8
y.create.l HWIO_QDSS_IN_FUN0_PERIPHID3_ADDR A:0x60821fec
y.create.l HWIO_QDSS_IN_FUN0_PERIPHID4_ADDR A:0x60821fd0
y.create.l HWIO_QDSS_IN_FUN0_PERIPHID5_ADDR A:0x60821fd4
y.create.l HWIO_QDSS_IN_FUN0_PERIPHID6_ADDR A:0x60821fd8
y.create.l HWIO_QDSS_IN_FUN0_PERIPHID7_ADDR A:0x60821fdc
y.create.l HWIO_QDSS_IN_FUN0_COMPID0_ADDR A:0x60821ff0
y.create.l HWIO_QDSS_IN_FUN0_COMPID1_ADDR A:0x60821ff4
y.create.l HWIO_QDSS_IN_FUN0_COMPID2_ADDR A:0x60821ff8
y.create.l HWIO_QDSS_IN_FUN0_COMPID3_ADDR A:0x60821ffc
y.create.l HWIO_QDSS_REPL64_IDFILTER0_ADDR A:0x60824000
y.create.l HWIO_QDSS_REPL64_IDFILTER1_ADDR A:0x60824004
y.create.l HWIO_QDSS_REPL64_ITATBCTR0_ADDR A:0x60824efc
y.create.l HWIO_QDSS_REPL64_ITATBCTR1_ADDR A:0x60824ef8
y.create.l HWIO_QDSS_REPL64_ITCTRL_ADDR A:0x60824f00
y.create.l HWIO_QDSS_REPL64_CLAIMSET_ADDR A:0x60824fa0
y.create.l HWIO_QDSS_REPL64_CLAIMCLR_ADDR A:0x60824fa4
y.create.l HWIO_QDSS_REPL64_LAR_ADDR A:0x60824fb0
y.create.l HWIO_QDSS_REPL64_LSR_ADDR A:0x60824fb4
y.create.l HWIO_QDSS_REPL64_AUTHSTATUS_ADDR A:0x60824fb8
y.create.l HWIO_QDSS_REPL64_DEVID_ADDR A:0x60824fc8
y.create.l HWIO_QDSS_REPL64_DEVTYPE_ADDR A:0x60824fcc
y.create.l HWIO_QDSS_REPL64_PIDR0_ADDR A:0x60824fe0
y.create.l HWIO_QDSS_REPL64_PIDR1_ADDR A:0x60824fe4
y.create.l HWIO_QDSS_REPL64_PIDR2_ADDR A:0x60824fe8
y.create.l HWIO_QDSS_REPL64_PIDR3_ADDR A:0x60824fec
y.create.l HWIO_QDSS_REPL64_PIDR4_ADDR A:0x60824fd0
y.create.l HWIO_QDSS_REPL64_PIDR5_ADDR A:0x60824fd4
y.create.l HWIO_QDSS_REPL64_PIDR6_ADDR A:0x60824fd8
y.create.l HWIO_QDSS_REPL64_PIDR7_ADDR A:0x60824fdc
y.create.l HWIO_QDSS_REPL64_CIDR0_ADDR A:0x60824ff0
y.create.l HWIO_QDSS_REPL64_CIDR1_ADDR A:0x60824ff4
y.create.l HWIO_QDSS_REPL64_CIDR2_ADDR A:0x60824ff8
y.create.l HWIO_QDSS_REPL64_CIDR3_ADDR A:0x60824ffc
y.create.l HWIO_QDSS_ETFETB_RSZ_ADDR A:0x60825004
y.create.l HWIO_QDSS_ETFETB_STS_ADDR A:0x6082500c
y.create.l HWIO_QDSS_ETFETB_RRD_ADDR A:0x60825010
y.create.l HWIO_QDSS_ETFETB_RRP_ADDR A:0x60825014
y.create.l HWIO_QDSS_ETFETB_RWP_ADDR A:0x60825018
y.create.l HWIO_QDSS_ETFETB_TRG_ADDR A:0x6082501c
y.create.l HWIO_QDSS_ETFETB_CTL_ADDR A:0x60825020
y.create.l HWIO_QDSS_ETFETB_RWD_ADDR A:0x60825024
y.create.l HWIO_QDSS_ETFETB_MODE_ADDR A:0x60825028
y.create.l HWIO_QDSS_ETFETB_LBUFLEVEL_ADDR A:0x6082502c
y.create.l HWIO_QDSS_ETFETB_CBUFLEVEL_ADDR A:0x60825030
y.create.l HWIO_QDSS_ETFETB_BUFWM_ADDR A:0x60825034
y.create.l HWIO_QDSS_ETFETB_FFSR_ADDR A:0x60825300
y.create.l HWIO_QDSS_ETFETB_FFCR_ADDR A:0x60825304
y.create.l HWIO_QDSS_ETFETB_PSCR_ADDR A:0x60825308
y.create.l HWIO_QDSS_ETFETB_ITATBMDATA0_ADDR A:0x60825ed0
y.create.l HWIO_QDSS_ETFETB_ITATBMCTR2_ADDR A:0x60825ed4
y.create.l HWIO_QDSS_ETFETB_ITATBMCTR1_ADDR A:0x60825ed8
y.create.l HWIO_QDSS_ETFETB_ITATBMCTR0_ADDR A:0x60825edc
y.create.l HWIO_QDSS_ETFETB_ITMISCOP0_ADDR A:0x60825ee0
y.create.l HWIO_QDSS_ETFETB_ITTRFLIN_ADDR A:0x60825ee8
y.create.l HWIO_QDSS_ETFETB_ITATBDATA0_ADDR A:0x60825eec
y.create.l HWIO_QDSS_ETFETB_ITATBCTR2_ADDR A:0x60825ef0
y.create.l HWIO_QDSS_ETFETB_ITATBCTR1_ADDR A:0x60825ef4
y.create.l HWIO_QDSS_ETFETB_ITATBCTR0_ADDR A:0x60825ef8
y.create.l HWIO_QDSS_ETFETB_ITCTRL_ADDR A:0x60825f00
y.create.l HWIO_QDSS_ETFETB_CLAIMSET_ADDR A:0x60825fa0
y.create.l HWIO_QDSS_ETFETB_CLAIMCLR_ADDR A:0x60825fa4
y.create.l HWIO_QDSS_ETFETB_LAR_ADDR A:0x60825fb0
y.create.l HWIO_QDSS_ETFETB_LSR_ADDR A:0x60825fb4
y.create.l HWIO_QDSS_ETFETB_AUTHSTATUS_ADDR A:0x60825fb8
y.create.l HWIO_QDSS_ETFETB_DEVID_ADDR A:0x60825fc8
y.create.l HWIO_QDSS_ETFETB_DEVTYPE_ADDR A:0x60825fcc
y.create.l HWIO_QDSS_ETFETB_PERIPHID0_ADDR A:0x60825fe0
y.create.l HWIO_QDSS_ETFETB_PERIPHID1_ADDR A:0x60825fe4
y.create.l HWIO_QDSS_ETFETB_PERIPHID2_ADDR A:0x60825fe8
y.create.l HWIO_QDSS_ETFETB_PERIPHID3_ADDR A:0x60825fec
y.create.l HWIO_QDSS_ETFETB_PERIPHID4_ADDR A:0x60825fd0
y.create.l HWIO_QDSS_ETFETB_PERIPHID5_ADDR A:0x60825fd4
y.create.l HWIO_QDSS_ETFETB_PERIPHID6_ADDR A:0x60825fd8
y.create.l HWIO_QDSS_ETFETB_PERIPHID7_ADDR A:0x60825fdc
y.create.l HWIO_QDSS_ETFETB_COMPID0_ADDR A:0x60825ff0
y.create.l HWIO_QDSS_ETFETB_COMPID1_ADDR A:0x60825ff4
y.create.l HWIO_QDSS_ETFETB_COMPID2_ADDR A:0x60825ff8
y.create.l HWIO_QDSS_ETFETB_COMPID3_ADDR A:0x60825ffc
y.create.l HWIO_QDSS_ETR_RSZ_ADDR A:0x60826004
y.create.l HWIO_QDSS_ETR_STS_ADDR A:0x6082600c
y.create.l HWIO_QDSS_ETR_RRD_ADDR A:0x60826010
y.create.l HWIO_QDSS_ETR_RRP_ADDR A:0x60826014
y.create.l HWIO_QDSS_ETR_RWP_ADDR A:0x60826018
y.create.l HWIO_QDSS_ETR_TRG_ADDR A:0x6082601c
y.create.l HWIO_QDSS_ETR_CTL_ADDR A:0x60826020
y.create.l HWIO_QDSS_ETR_RWD_ADDR A:0x60826024
y.create.l HWIO_QDSS_ETR_MODE_ADDR A:0x60826028
y.create.l HWIO_QDSS_ETR_LBUFLEVEL_ADDR A:0x6082602c
y.create.l HWIO_QDSS_ETR_CBUFLEVEL_ADDR A:0x60826030
y.create.l HWIO_QDSS_ETR_BUFWM_ADDR A:0x60826034
y.create.l HWIO_QDSS_ETR_RRPHI_ADDR A:0x60826038
y.create.l HWIO_QDSS_ETR_RWPHI_ADDR A:0x6082603c
y.create.l HWIO_QDSS_ETR_AXICTL_ADDR A:0x60826110
y.create.l HWIO_QDSS_ETR_DBALO_ADDR A:0x60826118
y.create.l HWIO_QDSS_ETR_DBAHI_ADDR A:0x6082611c
y.create.l HWIO_QDSS_ETR_FFSR_ADDR A:0x60826300
y.create.l HWIO_QDSS_ETR_FFCR_ADDR A:0x60826304
y.create.l HWIO_QDSS_ETR_PSCR_ADDR A:0x60826308
y.create.l HWIO_QDSS_ETR_ITMISCOP0_ADDR A:0x60826ee0
y.create.l HWIO_QDSS_ETR_ITTRFLIN_ADDR A:0x60826ee8
y.create.l HWIO_QDSS_ETR_ITATBDATA0_ADDR A:0x60826eec
y.create.l HWIO_QDSS_ETR_ITATBCTR2_ADDR A:0x60826ef0
y.create.l HWIO_QDSS_ETR_ITATBCTR1_ADDR A:0x60826ef4
y.create.l HWIO_QDSS_ETR_ITATBCTR0_ADDR A:0x60826ef8
y.create.l HWIO_QDSS_ETR_ITCTRL_ADDR A:0x60826f00
y.create.l HWIO_QDSS_ETR_CLAIMSET_ADDR A:0x60826fa0
y.create.l HWIO_QDSS_ETR_CLAIMCLR_ADDR A:0x60826fa4
y.create.l HWIO_QDSS_ETR_LAR_ADDR A:0x60826fb0
y.create.l HWIO_QDSS_ETR_LSR_ADDR A:0x60826fb4
y.create.l HWIO_QDSS_ETR_AUTHSTATUS_ADDR A:0x60826fb8
y.create.l HWIO_QDSS_ETR_DEVID_ADDR A:0x60826fc8
y.create.l HWIO_QDSS_ETR_DEVTYPE_ADDR A:0x60826fcc
y.create.l HWIO_QDSS_ETR_PERIPHID0_ADDR A:0x60826fe0
y.create.l HWIO_QDSS_ETR_PERIPHID1_ADDR A:0x60826fe4
y.create.l HWIO_QDSS_ETR_PERIPHID2_ADDR A:0x60826fe8
y.create.l HWIO_QDSS_ETR_PERIPHID3_ADDR A:0x60826fec
y.create.l HWIO_QDSS_ETR_PERIPHID4_ADDR A:0x60826fd0
y.create.l HWIO_QDSS_ETR_PERIPHID5_ADDR A:0x60826fd4
y.create.l HWIO_QDSS_ETR_PERIPHID6_ADDR A:0x60826fd8
y.create.l HWIO_QDSS_ETR_PERIPHID7_ADDR A:0x60826fdc
y.create.l HWIO_QDSS_ETR_COMPID0_ADDR A:0x60826ff0
y.create.l HWIO_QDSS_ETR_COMPID1_ADDR A:0x60826ff4
y.create.l HWIO_QDSS_ETR_COMPID2_ADDR A:0x60826ff8
y.create.l HWIO_QDSS_ETR_COMPID3_ADDR A:0x60826ffc
y.create.l HWIO_QDSS_NDPBAM_BAM_CTRL_ADDR A:0x60884000
y.create.l HWIO_QDSS_NDPBAM_BAM_TIMER_ADDR A:0x60884040
y.create.l HWIO_QDSS_NDPBAM_BAM_TIMER_CTRL_ADDR A:0x60884044
y.create.l HWIO_QDSS_NDPBAM_BAM_DESC_CNT_TRSHLD_ADDR A:0x60884008
y.create.l HWIO_QDSS_NDPBAM_BAM_IRQ_STTS_ADDR A:0x60884014
y.create.l HWIO_QDSS_NDPBAM_BAM_IRQ_CLR_ADDR A:0x60884018
y.create.l HWIO_QDSS_NDPBAM_BAM_IRQ_EN_ADDR A:0x6088401c
y.create.l HWIO_QDSS_NDPBAM_BAM_CNFG_BITS_ADDR A:0x6088407c
y.create.l HWIO_QDSS_NDPBAM_BAM_REVISION_ADDR A:0x60885000
y.create.l HWIO_QDSS_NDPBAM_BAM_SW_VERSION_ADDR A:0x60885004
y.create.l HWIO_QDSS_NDPBAM_BAM_NUM_PIPES_ADDR A:0x60885008
y.create.l HWIO_QDSS_NDPBAM_BAM_TEST_BUS_SEL_ADDR A:0x60885010
y.create.l HWIO_QDSS_NDPBAM_BAM_TEST_BUS_REG_ADDR A:0x60885014
y.create.l HWIO_QDSS_NDPBAM_BAM_AHB_MASTER_ERR_CTRLS_ADDR A:0x60885024
y.create.l HWIO_QDSS_NDPBAM_BAM_AHB_MASTER_ERR_ADDR_ADDR A:0x60885028
y.create.l HWIO_QDSS_NDPBAM_BAM_AHB_MASTER_ERR_DATA_ADDR A:0x6088502c
y.create.l HWIO_QDSS_NDPBAM_BAM_AHB_MASTER_ERR_ADDR_LSB_ADDR A:0x60885100
y.create.l HWIO_QDSS_NDPBAM_BAM_AHB_MASTER_ERR_ADDR_MSB_ADDR A:0x60885104
y.create.l HWIO_QDSS_NDPBAM_BAM_TRUST_REG_ADDR A:0x60886000
y.create.l HWIO_QDSS_NDPBAM_BAM_P_TRUST_REG0_ADDR A:0x60886020
y.create.l HWIO_QDSS_NDPBAM_BAM_P_TRUST_REG1_ADDR A:0x60886024
y.create.l HWIO_QDSS_NDPBAM_BAM_IRQ_SRCS_EE0_ADDR A:0x60887000
y.create.l HWIO_QDSS_NDPBAM_BAM_IRQ_SRCS_EE1_ADDR A:0x60888000
y.create.l HWIO_QDSS_NDPBAM_BAM_IRQ_SRCS_EE2_ADDR A:0x60889000
y.create.l HWIO_QDSS_NDPBAM_BAM_IRQ_SRCS_EE3_ADDR A:0x6088a000
y.create.l HWIO_QDSS_NDPBAM_BAM_IRQ_SRCS_EE4_ADDR A:0x6088b000
y.create.l HWIO_QDSS_NDPBAM_BAM_IRQ_SRCS_EE5_ADDR A:0x6088c000
y.create.l HWIO_QDSS_NDPBAM_BAM_IRQ_SRCS_EE6_ADDR A:0x6088d000
y.create.l HWIO_QDSS_NDPBAM_BAM_IRQ_SRCS_EE7_ADDR A:0x6088e000
y.create.l HWIO_QDSS_NDPBAM_BAM_IRQ_SRCS_MSK_EE0_ADDR A:0x60887004
y.create.l HWIO_QDSS_NDPBAM_BAM_IRQ_SRCS_MSK_EE1_ADDR A:0x60888004
y.create.l HWIO_QDSS_NDPBAM_BAM_IRQ_SRCS_MSK_EE2_ADDR A:0x60889004
y.create.l HWIO_QDSS_NDPBAM_BAM_IRQ_SRCS_MSK_EE3_ADDR A:0x6088a004
y.create.l HWIO_QDSS_NDPBAM_BAM_IRQ_SRCS_MSK_EE4_ADDR A:0x6088b004
y.create.l HWIO_QDSS_NDPBAM_BAM_IRQ_SRCS_MSK_EE5_ADDR A:0x6088c004
y.create.l HWIO_QDSS_NDPBAM_BAM_IRQ_SRCS_MSK_EE6_ADDR A:0x6088d004
y.create.l HWIO_QDSS_NDPBAM_BAM_IRQ_SRCS_MSK_EE7_ADDR A:0x6088e004
y.create.l HWIO_QDSS_NDPBAM_BAM_IRQ_SRCS_UNMASKED_EE0_ADDR A:0x60887008
y.create.l HWIO_QDSS_NDPBAM_BAM_IRQ_SRCS_UNMASKED_EE1_ADDR A:0x60888008
y.create.l HWIO_QDSS_NDPBAM_BAM_IRQ_SRCS_UNMASKED_EE2_ADDR A:0x60889008
y.create.l HWIO_QDSS_NDPBAM_BAM_IRQ_SRCS_UNMASKED_EE3_ADDR A:0x6088a008
y.create.l HWIO_QDSS_NDPBAM_BAM_IRQ_SRCS_UNMASKED_EE4_ADDR A:0x6088b008
y.create.l HWIO_QDSS_NDPBAM_BAM_IRQ_SRCS_UNMASKED_EE5_ADDR A:0x6088c008
y.create.l HWIO_QDSS_NDPBAM_BAM_IRQ_SRCS_UNMASKED_EE6_ADDR A:0x6088d008
y.create.l HWIO_QDSS_NDPBAM_BAM_IRQ_SRCS_UNMASKED_EE7_ADDR A:0x6088e008
y.create.l HWIO_QDSS_NDPBAM_BAM_PIPE_ATTR_EE0_ADDR A:0x6088700c
y.create.l HWIO_QDSS_NDPBAM_BAM_PIPE_ATTR_EE1_ADDR A:0x6088800c
y.create.l HWIO_QDSS_NDPBAM_BAM_PIPE_ATTR_EE2_ADDR A:0x6088900c
y.create.l HWIO_QDSS_NDPBAM_BAM_PIPE_ATTR_EE3_ADDR A:0x6088a00c
y.create.l HWIO_QDSS_NDPBAM_BAM_PIPE_ATTR_EE4_ADDR A:0x6088b00c
y.create.l HWIO_QDSS_NDPBAM_BAM_PIPE_ATTR_EE5_ADDR A:0x6088c00c
y.create.l HWIO_QDSS_NDPBAM_BAM_PIPE_ATTR_EE6_ADDR A:0x6088d00c
y.create.l HWIO_QDSS_NDPBAM_BAM_PIPE_ATTR_EE7_ADDR A:0x6088e00c
y.create.l HWIO_QDSS_NDPBAM_BAM_IRQ_SRCS_ADDR A:0x60887010
y.create.l HWIO_QDSS_NDPBAM_BAM_IRQ_SRCS_MSK_ADDR A:0x60887014
y.create.l HWIO_QDSS_NDPBAM_BAM_IRQ_SRCS_UNMASKED_ADDR A:0x60887018
y.create.l HWIO_QDSS_NDPBAM_BAM_P_CTRL0_ADDR A:0x60897000
y.create.l HWIO_QDSS_NDPBAM_BAM_P_CTRL1_ADDR A:0x60898000
y.create.l HWIO_QDSS_NDPBAM_BAM_P_RST0_ADDR A:0x60897004
y.create.l HWIO_QDSS_NDPBAM_BAM_P_RST1_ADDR A:0x60898004
y.create.l HWIO_QDSS_NDPBAM_BAM_P_HALT0_ADDR A:0x60897008
y.create.l HWIO_QDSS_NDPBAM_BAM_P_HALT1_ADDR A:0x60898008
y.create.l HWIO_QDSS_NDPBAM_BAM_P_IRQ_STTS0_ADDR A:0x60897010
y.create.l HWIO_QDSS_NDPBAM_BAM_P_IRQ_STTS1_ADDR A:0x60898010
y.create.l HWIO_QDSS_NDPBAM_BAM_P_IRQ_CLR0_ADDR A:0x60897014
y.create.l HWIO_QDSS_NDPBAM_BAM_P_IRQ_CLR1_ADDR A:0x60898014
y.create.l HWIO_QDSS_NDPBAM_BAM_P_IRQ_EN0_ADDR A:0x60897018
y.create.l HWIO_QDSS_NDPBAM_BAM_P_IRQ_EN1_ADDR A:0x60898018
y.create.l HWIO_QDSS_NDPBAM_BAM_P_TIMER0_ADDR A:0x6089701c
y.create.l HWIO_QDSS_NDPBAM_BAM_P_TIMER1_ADDR A:0x6089801c
y.create.l HWIO_QDSS_NDPBAM_BAM_P_TIMER_CTRL0_ADDR A:0x60897020
y.create.l HWIO_QDSS_NDPBAM_BAM_P_TIMER_CTRL1_ADDR A:0x60898020
y.create.l HWIO_QDSS_NDPBAM_BAM_P_PRDCR_SDBND0_ADDR A:0x60897024
y.create.l HWIO_QDSS_NDPBAM_BAM_P_PRDCR_SDBND1_ADDR A:0x60898024
y.create.l HWIO_QDSS_NDPBAM_BAM_P_CNSMR_SDBND0_ADDR A:0x60897028
y.create.l HWIO_QDSS_NDPBAM_BAM_P_CNSMR_SDBND1_ADDR A:0x60898028
y.create.l HWIO_QDSS_NDPBAM_BAM_P_SW_OFSTS0_ADDR A:0x60897800
y.create.l HWIO_QDSS_NDPBAM_BAM_P_SW_OFSTS1_ADDR A:0x60898800
y.create.l HWIO_QDSS_NDPBAM_BAM_P_AU_PSM_CNTXT_1_0_ADDR A:0x60897804
y.create.l HWIO_QDSS_NDPBAM_BAM_P_AU_PSM_CNTXT_1_1_ADDR A:0x60898804
y.create.l HWIO_QDSS_NDPBAM_BAM_P_PSM_CNTXT_2_0_ADDR A:0x60897808
y.create.l HWIO_QDSS_NDPBAM_BAM_P_PSM_CNTXT_2_1_ADDR A:0x60898808
y.create.l HWIO_QDSS_NDPBAM_BAM_P_PSM_CNTXT_3_0_ADDR A:0x6089780c
y.create.l HWIO_QDSS_NDPBAM_BAM_P_PSM_CNTXT_3_1_ADDR A:0x6089880c
y.create.l HWIO_QDSS_NDPBAM_BAM_P_PSM_CNTXT_4_0_ADDR A:0x60897810
y.create.l HWIO_QDSS_NDPBAM_BAM_P_PSM_CNTXT_4_1_ADDR A:0x60898810
y.create.l HWIO_QDSS_NDPBAM_BAM_P_PSM_CNTXT_5_0_ADDR A:0x60897814
y.create.l HWIO_QDSS_NDPBAM_BAM_P_PSM_CNTXT_5_1_ADDR A:0x60898814
y.create.l HWIO_QDSS_NDPBAM_BAM_P_EVNT_REG0_ADDR A:0x60897818
y.create.l HWIO_QDSS_NDPBAM_BAM_P_EVNT_REG1_ADDR A:0x60898818
y.create.l HWIO_QDSS_NDPBAM_BAM_P_DESC_FIFO_ADDR0_ADDR A:0x6089781c
y.create.l HWIO_QDSS_NDPBAM_BAM_P_DESC_FIFO_ADDR1_ADDR A:0x6089881c
y.create.l HWIO_QDSS_NDPBAM_BAM_P_FIFO_SIZES0_ADDR A:0x60897820
y.create.l HWIO_QDSS_NDPBAM_BAM_P_FIFO_SIZES1_ADDR A:0x60898820
y.create.l HWIO_QDSS_NDPBAM_BAM_P_DATA_FIFO_ADDR0_ADDR A:0x60897824
y.create.l HWIO_QDSS_NDPBAM_BAM_P_DATA_FIFO_ADDR1_ADDR A:0x60898824
y.create.l HWIO_QDSS_NDPBAM_BAM_P_EVNT_GEN_TRSHLD0_ADDR A:0x60897828
y.create.l HWIO_QDSS_NDPBAM_BAM_P_EVNT_GEN_TRSHLD1_ADDR A:0x60898828
y.create.l HWIO_QDSS_NDPBAM_BAM_P_EVNT_DEST_ADDR0_ADDR A:0x6089782c
y.create.l HWIO_QDSS_NDPBAM_BAM_P_EVNT_DEST_ADDR1_ADDR A:0x6089882c
y.create.l HWIO_QDSS_NDPBAM_BAM_P_DF_CNTXT_0_ADDR A:0x60897830
y.create.l HWIO_QDSS_NDPBAM_BAM_P_DF_CNTXT_1_ADDR A:0x60898830
y.create.l HWIO_QDSS_NDPBAM_BAM_P_RETR_CNTXT_0_ADDR A:0x60897834
y.create.l HWIO_QDSS_NDPBAM_BAM_P_RETR_CNTXT_1_ADDR A:0x60898834
y.create.l HWIO_QDSS_NDPBAM_BAM_P_SI_CNTXT_0_ADDR A:0x60897838
y.create.l HWIO_QDSS_NDPBAM_BAM_P_SI_CNTXT_1_ADDR A:0x60898838
y.create.l HWIO_QDSS_NDPBAM_BAM_P_PSM_CNTXT_3_LSB0_ADDR A:0x60897900
y.create.l HWIO_QDSS_NDPBAM_BAM_P_PSM_CNTXT_3_LSB1_ADDR A:0x60898900
y.create.l HWIO_QDSS_NDPBAM_BAM_P_PSM_CNTXT_3_MSB0_ADDR A:0x60897904
y.create.l HWIO_QDSS_NDPBAM_BAM_P_PSM_CNTXT_3_MSB1_ADDR A:0x60898904
y.create.l HWIO_QDSS_NDPBAM_BAM_P_DESC_FIFO_ADDR_LSB0_ADDR A:0x60897910
y.create.l HWIO_QDSS_NDPBAM_BAM_P_DESC_FIFO_ADDR_LSB1_ADDR A:0x60898910
y.create.l HWIO_QDSS_NDPBAM_BAM_P_DESC_FIFO_ADDR_MSB0_ADDR A:0x60897914
y.create.l HWIO_QDSS_NDPBAM_BAM_P_DESC_FIFO_ADDR_MSB1_ADDR A:0x60898914
y.create.l HWIO_QDSS_NDPBAM_BAM_P_DATA_FIFO_ADDR_LSB0_ADDR A:0x60897920
y.create.l HWIO_QDSS_NDPBAM_BAM_P_DATA_FIFO_ADDR_LSB1_ADDR A:0x60898920
y.create.l HWIO_QDSS_NDPBAM_BAM_P_DATA_FIFO_ADDR_MSB0_ADDR A:0x60897924
y.create.l HWIO_QDSS_NDPBAM_BAM_P_DATA_FIFO_ADDR_MSB1_ADDR A:0x60898924
y.create.l HWIO_QDSS_NDPBAM_BAM_P_EVNT_DEST_ADDR_LSB0_ADDR A:0x60897930
y.create.l HWIO_QDSS_NDPBAM_BAM_P_EVNT_DEST_ADDR_LSB1_ADDR A:0x60898930
y.create.l HWIO_QDSS_NDPBAM_BAM_P_EVNT_DEST_ADDR_MSB0_ADDR A:0x60897934
y.create.l HWIO_QDSS_NDPBAM_BAM_P_EVNT_DEST_ADDR_MSB1_ADDR A:0x60898934
y.create.l HWIO_QDSS_WRAPPER_ATB_FUN2X1_CTRL_REG_ADDR A:0x60868000
y.create.l HWIO_QDSS_WRAPPER_ATB_FUN2X1_PRIORITY_CTRL_REG_ADDR A:0x60868004
y.create.l HWIO_QDSS_WRAPPER_ATB_FUN2X1_ITATBDATA0_ADDR A:0x60868eec
y.create.l HWIO_QDSS_WRAPPER_ATB_FUN2X1_ITATBCTR2_ADDR A:0x60868ef0
y.create.l HWIO_QDSS_WRAPPER_ATB_FUN2X1_ITATBCTR1_ADDR A:0x60868ef4
y.create.l HWIO_QDSS_WRAPPER_ATB_FUN2X1_ITATBCTR0_ADDR A:0x60868ef8
y.create.l HWIO_QDSS_WRAPPER_ATB_FUN2X1_ITCTRL_ADDR A:0x60868f00
y.create.l HWIO_QDSS_WRAPPER_ATB_FUN2X1_CLAIMSET_ADDR A:0x60868fa0
y.create.l HWIO_QDSS_WRAPPER_ATB_FUN2X1_CLAIMCLR_ADDR A:0x60868fa4
y.create.l HWIO_QDSS_WRAPPER_ATB_FUN2X1_LOCKACCESS_ADDR A:0x60868fb0
y.create.l HWIO_QDSS_WRAPPER_ATB_FUN2X1_LOCKSTATUS_ADDR A:0x60868fb4
y.create.l HWIO_QDSS_WRAPPER_ATB_FUN2X1_AUTHSTATUS_ADDR A:0x60868fb8
y.create.l HWIO_QDSS_WRAPPER_ATB_FUN2X1_DEVID_ADDR A:0x60868fc8
y.create.l HWIO_QDSS_WRAPPER_ATB_FUN2X1_DEVTYPE_ADDR A:0x60868fcc
y.create.l HWIO_QDSS_WRAPPER_ATB_FUN2X1_PERIPHID0_ADDR A:0x60868fe0
y.create.l HWIO_QDSS_WRAPPER_ATB_FUN2X1_PERIPHID1_ADDR A:0x60868fe4
y.create.l HWIO_QDSS_WRAPPER_ATB_FUN2X1_PERIPHID2_ADDR A:0x60868fe8
y.create.l HWIO_QDSS_WRAPPER_ATB_FUN2X1_PERIPHID3_ADDR A:0x60868fec
y.create.l HWIO_QDSS_WRAPPER_ATB_FUN2X1_PERIPHID4_ADDR A:0x60868fd0
y.create.l HWIO_QDSS_WRAPPER_ATB_FUN2X1_PERIPHID5_ADDR A:0x60868fd4
y.create.l HWIO_QDSS_WRAPPER_ATB_FUN2X1_PERIPHID6_ADDR A:0x60868fd8
y.create.l HWIO_QDSS_WRAPPER_ATB_FUN2X1_PERIPHID7_ADDR A:0x60868fdc
y.create.l HWIO_QDSS_WRAPPER_ATB_FUN2X1_COMPID0_ADDR A:0x60868ff0
y.create.l HWIO_QDSS_WRAPPER_ATB_FUN2X1_COMPID1_ADDR A:0x60868ff4
y.create.l HWIO_QDSS_WRAPPER_ATB_FUN2X1_COMPID2_ADDR A:0x60868ff8
y.create.l HWIO_QDSS_WRAPPER_ATB_FUN2X1_COMPID3_ADDR A:0x60868ffc
y.create.l HWIO_QDSS_WRAPPER_ATB_FUN8X1_CTRL_REG_ADDR A:0x60869000
y.create.l HWIO_QDSS_WRAPPER_ATB_FUN8X1_PRIORITY_CTRL_REG_ADDR A:0x60869004
y.create.l HWIO_QDSS_WRAPPER_ATB_FUN8X1_ITATBDATA0_ADDR A:0x60869eec
y.create.l HWIO_QDSS_WRAPPER_ATB_FUN8X1_ITATBCTR2_ADDR A:0x60869ef0
y.create.l HWIO_QDSS_WRAPPER_ATB_FUN8X1_ITATBCTR1_ADDR A:0x60869ef4
y.create.l HWIO_QDSS_WRAPPER_ATB_FUN8X1_ITATBCTR0_ADDR A:0x60869ef8
y.create.l HWIO_QDSS_WRAPPER_ATB_FUN8X1_ITCTRL_ADDR A:0x60869f00
y.create.l HWIO_QDSS_WRAPPER_ATB_FUN8X1_CLAIMSET_ADDR A:0x60869fa0
y.create.l HWIO_QDSS_WRAPPER_ATB_FUN8X1_CLAIMCLR_ADDR A:0x60869fa4
y.create.l HWIO_QDSS_WRAPPER_ATB_FUN8X1_LOCKACCESS_ADDR A:0x60869fb0
y.create.l HWIO_QDSS_WRAPPER_ATB_FUN8X1_LOCKSTATUS_ADDR A:0x60869fb4
y.create.l HWIO_QDSS_WRAPPER_ATB_FUN8X1_AUTHSTATUS_ADDR A:0x60869fb8
y.create.l HWIO_QDSS_WRAPPER_ATB_FUN8X1_DEVID_ADDR A:0x60869fc8
y.create.l HWIO_QDSS_WRAPPER_ATB_FUN8X1_DEVTYPE_ADDR A:0x60869fcc
y.create.l HWIO_QDSS_WRAPPER_ATB_FUN8X1_PERIPHID0_ADDR A:0x60869fe0
y.create.l HWIO_QDSS_WRAPPER_ATB_FUN8X1_PERIPHID1_ADDR A:0x60869fe4
y.create.l HWIO_QDSS_WRAPPER_ATB_FUN8X1_PERIPHID2_ADDR A:0x60869fe8
y.create.l HWIO_QDSS_WRAPPER_ATB_FUN8X1_PERIPHID3_ADDR A:0x60869fec
y.create.l HWIO_QDSS_WRAPPER_ATB_FUN8X1_PERIPHID4_ADDR A:0x60869fd0
y.create.l HWIO_QDSS_WRAPPER_ATB_FUN8X1_PERIPHID5_ADDR A:0x60869fd4
y.create.l HWIO_QDSS_WRAPPER_ATB_FUN8X1_PERIPHID6_ADDR A:0x60869fd8
y.create.l HWIO_QDSS_WRAPPER_ATB_FUN8X1_PERIPHID7_ADDR A:0x60869fdc
y.create.l HWIO_QDSS_WRAPPER_ATB_FUN8X1_COMPID0_ADDR A:0x60869ff0
y.create.l HWIO_QDSS_WRAPPER_ATB_FUN8X1_COMPID1_ADDR A:0x60869ff4
y.create.l HWIO_QDSS_WRAPPER_ATB_FUN8X1_COMPID2_ADDR A:0x60869ff8
y.create.l HWIO_QDSS_WRAPPER_ATB_FUN8X1_COMPID3_ADDR A:0x60869ffc
y.create.l HWIO_QDSS_WRAPPER_HWEVENT_EXPD_COL0_OEN_REG_ADDR A:0x6086c000
y.create.l HWIO_QDSS_WRAPPER_HWEVENT_EXPD_COL1_OEN_REG_ADDR A:0x6086c004
y.create.l HWIO_QDSS_WRAPPER_HWEVENT_EXPD_COL2_OEN_REG_ADDR A:0x6086c008
y.create.l HWIO_QDSS_WRAPPER_HWEVENT_EXPD_COL3_OEN_REG_ADDR A:0x6086c00c
y.create.l HWIO_QDSS_WRAPPER_HWEVENT_EXPD_COL4_OEN_REG_ADDR A:0x6086c010
y.create.l HWIO_QDSS_WRAPPER_HWEVENT_EXPD_COL5_OEN_REG_ADDR A:0x6086c014
y.create.l HWIO_QDSS_WRAPPER_HWEVENT_EXPD_COL6_OEN_REG_ADDR A:0x6086c018
y.create.l HWIO_QDSS_WRAPPER_HWEVENT_EXPD_COL7_OEN_REG_ADDR A:0x6086c01c
y.create.l HWIO_QDSS_WRAPPER_HWEVENT_EXPD_COL8_OEN_REG_ADDR A:0x6086c020
y.create.l HWIO_QDSS_WRAPPER_HWEVENT_EXPD_COL9_OEN_REG_ADDR A:0x6086c024
y.create.l HWIO_QDSS_WRAPPER_HWEVENT_EXPD_COL0_MUX_SEL0_REG_ADDR A:0x6086c040
y.create.l HWIO_QDSS_WRAPPER_HWEVENT_EXPD_COL1_MUX_SEL0_REG_ADDR A:0x6086c050
y.create.l HWIO_QDSS_WRAPPER_HWEVENT_EXPD_COL2_MUX_SEL0_REG_ADDR A:0x6086c060
y.create.l HWIO_QDSS_WRAPPER_HWEVENT_EXPD_COL3_MUX_SEL0_REG_ADDR A:0x6086c070
y.create.l HWIO_QDSS_WRAPPER_HWEVENT_EXPD_COL4_MUX_SEL0_REG_ADDR A:0x6086c080
y.create.l HWIO_QDSS_WRAPPER_HWEVENT_EXPD_COL5_MUX_SEL0_REG_ADDR A:0x6086c090
y.create.l HWIO_QDSS_WRAPPER_HWEVENT_EXPD_COL6_MUX_SEL0_REG_ADDR A:0x6086c0a0
y.create.l HWIO_QDSS_WRAPPER_HWEVENT_EXPD_COL7_MUX_SEL0_REG_ADDR A:0x6086c0b0
y.create.l HWIO_QDSS_WRAPPER_HWEVENT_EXPD_COL8_MUX_SEL0_REG_ADDR A:0x6086c0c0
y.create.l HWIO_QDSS_WRAPPER_HWEVENT_EXPD_COL9_MUX_SEL0_REG_ADDR A:0x6086c0d0
y.create.l HWIO_QDSS_WRAPPER_HWEVENT_EXPD_COL0_MUX_SEL1_REG_ADDR A:0x6086c044
y.create.l HWIO_QDSS_WRAPPER_HWEVENT_EXPD_COL1_MUX_SEL1_REG_ADDR A:0x6086c054
y.create.l HWIO_QDSS_WRAPPER_HWEVENT_EXPD_COL2_MUX_SEL1_REG_ADDR A:0x6086c064
y.create.l HWIO_QDSS_WRAPPER_HWEVENT_EXPD_COL3_MUX_SEL1_REG_ADDR A:0x6086c074
y.create.l HWIO_QDSS_WRAPPER_HWEVENT_EXPD_COL4_MUX_SEL1_REG_ADDR A:0x6086c084
y.create.l HWIO_QDSS_WRAPPER_HWEVENT_EXPD_COL5_MUX_SEL1_REG_ADDR A:0x6086c094
y.create.l HWIO_QDSS_WRAPPER_HWEVENT_EXPD_COL6_MUX_SEL1_REG_ADDR A:0x6086c0a4
y.create.l HWIO_QDSS_WRAPPER_HWEVENT_EXPD_COL7_MUX_SEL1_REG_ADDR A:0x6086c0b4
y.create.l HWIO_QDSS_WRAPPER_HWEVENT_EXPD_COL8_MUX_SEL1_REG_ADDR A:0x6086c0c4
y.create.l HWIO_QDSS_WRAPPER_HWEVENT_EXPD_COL9_MUX_SEL1_REG_ADDR A:0x6086c0d4
y.create.l HWIO_QDSS_WRAPPER_HWEVENT_EXPD_COL0_MUX_SEL2_REG_ADDR A:0x6086c048
y.create.l HWIO_QDSS_WRAPPER_HWEVENT_EXPD_COL1_MUX_SEL2_REG_ADDR A:0x6086c058
y.create.l HWIO_QDSS_WRAPPER_HWEVENT_EXPD_COL2_MUX_SEL2_REG_ADDR A:0x6086c068
y.create.l HWIO_QDSS_WRAPPER_HWEVENT_EXPD_COL3_MUX_SEL2_REG_ADDR A:0x6086c078
y.create.l HWIO_QDSS_WRAPPER_HWEVENT_EXPD_COL4_MUX_SEL2_REG_ADDR A:0x6086c088
y.create.l HWIO_QDSS_WRAPPER_HWEVENT_EXPD_COL5_MUX_SEL2_REG_ADDR A:0x6086c098
y.create.l HWIO_QDSS_WRAPPER_HWEVENT_EXPD_COL6_MUX_SEL2_REG_ADDR A:0x6086c0a8
y.create.l HWIO_QDSS_WRAPPER_HWEVENT_EXPD_COL7_MUX_SEL2_REG_ADDR A:0x6086c0b8
y.create.l HWIO_QDSS_WRAPPER_HWEVENT_EXPD_COL8_MUX_SEL2_REG_ADDR A:0x6086c0c8
y.create.l HWIO_QDSS_WRAPPER_HWEVENT_EXPD_COL9_MUX_SEL2_REG_ADDR A:0x6086c0d8
y.create.l HWIO_QDSS_WRAPPER_HWEVENT_EXPD_COL0_MUX_SEL3_REG_ADDR A:0x6086c04c
y.create.l HWIO_QDSS_WRAPPER_HWEVENT_EXPD_COL1_MUX_SEL3_REG_ADDR A:0x6086c05c
y.create.l HWIO_QDSS_WRAPPER_HWEVENT_EXPD_COL2_MUX_SEL3_REG_ADDR A:0x6086c06c
y.create.l HWIO_QDSS_WRAPPER_HWEVENT_EXPD_COL3_MUX_SEL3_REG_ADDR A:0x6086c07c
y.create.l HWIO_QDSS_WRAPPER_HWEVENT_EXPD_COL4_MUX_SEL3_REG_ADDR A:0x6086c08c
y.create.l HWIO_QDSS_WRAPPER_HWEVENT_EXPD_COL5_MUX_SEL3_REG_ADDR A:0x6086c09c
y.create.l HWIO_QDSS_WRAPPER_HWEVENT_EXPD_COL6_MUX_SEL3_REG_ADDR A:0x6086c0ac
y.create.l HWIO_QDSS_WRAPPER_HWEVENT_EXPD_COL7_MUX_SEL3_REG_ADDR A:0x6086c0bc
y.create.l HWIO_QDSS_WRAPPER_HWEVENT_EXPD_COL8_MUX_SEL3_REG_ADDR A:0x6086c0cc
y.create.l HWIO_QDSS_WRAPPER_HWEVENT_EXPD_COL9_MUX_SEL3_REG_ADDR A:0x6086c0dc
y.create.l HWIO_QDSS_WRAPPER_IRQ_MUX_REG_ADDR A:0x6086c140
y.create.l HWIO_QDSS_WRAPPER_HWE_SPDM_MUX_REG_ADDR A:0x6086c144
y.create.l HWIO_QDSS_WRAPPER_CS_HWE_EXPD_ITCTL_ADDR A:0x6086cf00
y.create.l HWIO_QDSS_WRAPPER_CS_HWE_EXPD_CLAIMSET_ADDR A:0x6086cfa0
y.create.l HWIO_QDSS_WRAPPER_CS_HWE_EXPD_CLAIMCLR_ADDR A:0x6086cfa4
y.create.l HWIO_QDSS_WRAPPER_CS_HWE_EXPD_LOCKACCESS_ADDR A:0x6086cfb0
y.create.l HWIO_QDSS_WRAPPER_CS_HWE_EXPD_LOCKSTATUS_ADDR A:0x6086cfb4
y.create.l HWIO_QDSS_WRAPPER_CS_HWE_EXPD_AUTHSTATUS_ADDR A:0x6086cfb8
y.create.l HWIO_QDSS_WRAPPER_CS_HWE_EXPD_DEVICEID_ADDR A:0x6086cfc8
y.create.l HWIO_QDSS_WRAPPER_CS_HWE_EXPD_DEVICETYPE_ADDR A:0x6086cfcc
y.create.l HWIO_QDSS_WRAPPER_CS_HWE_EXPD_PERIPHID4_ADDR A:0x6086cfd0
y.create.l HWIO_QDSS_WRAPPER_CS_HWE_EXPD_PERIPHID5_ADDR A:0x6086cfd4
y.create.l HWIO_QDSS_WRAPPER_CS_HWE_EXPD_PERIPHID6_ADDR A:0x6086cfd8
y.create.l HWIO_QDSS_WRAPPER_CS_HWE_EXPD_PERIPHID7_ADDR A:0x6086cfdc
y.create.l HWIO_QDSS_WRAPPER_CS_HWE_EXPD_PERIPHID0_ADDR A:0x6086cfe0
y.create.l HWIO_QDSS_WRAPPER_CS_HWE_EXPD_PERIPHID1_ADDR A:0x6086cfe4
y.create.l HWIO_QDSS_WRAPPER_CS_HWE_EXPD_PERIPHID2_ADDR A:0x6086cfe8
y.create.l HWIO_QDSS_WRAPPER_CS_HWE_EXPD_PERIPHID3_ADDR A:0x6086cfec
y.create.l HWIO_QDSS_WRAPPER_CS_HWE_EXPD_COMPID0_ADDR A:0x6086cff0
y.create.l HWIO_QDSS_WRAPPER_CS_HWE_EXPD_COMPID1_ADDR A:0x6086cff4
y.create.l HWIO_QDSS_WRAPPER_CS_HWE_EXPD_COMPID2_ADDR A:0x6086cff8
y.create.l HWIO_QDSS_WRAPPER_CS_HWE_EXPD_COMPID3_ADDR A:0x6086cffc
y.create.l HWIO_QDSS_WRAPPER_DEBUG_UI_SECURE_ADDR A:0x6086d000
y.create.l HWIO_QDSS_WRAPPER_DEBUG_UI_CTL_ADDR A:0x6086d004
y.create.l HWIO_QDSS_WRAPPER_DEBUG_UI_CTL_MASK_ADDR A:0x6086d008
y.create.l HWIO_QDSS_WRAPPER_DEBUG_UI_SWTRIG_ADDR A:0x6086d00c
y.create.l HWIO_QDSS_WRAPPER_DEBUG_UI_STATUS_ADDR A:0x6086d010
y.create.l HWIO_QDSS_WRAPPER_DEBUG_UI_HWE_MASK_ADDR A:0x6086d014
y.create.l HWIO_QDSS_WRAPPER_DEBUG_UI_CTR_VAL_ADDR A:0x6086d018
y.create.l HWIO_QDSS_WRAPPER_DEBUG_UI_CTR_EN_ADDR A:0x6086d01c
y.create.l HWIO_QDSS_WRAPPER_DEBUG_UI_NUM_REGS_RD_ADDR A:0x6086d020
y.create.l HWIO_QDSS_WRAPPER_DEBUG_UI_ATB_REG_ADDR A:0x6086d024
y.create.l HWIO_QDSS_WRAPPER_DEBUG_UI_ADDR_0_ADDR A:0x6086d030
y.create.l HWIO_QDSS_WRAPPER_DEBUG_UI_ADDR_1_ADDR A:0x6086d034
y.create.l HWIO_QDSS_WRAPPER_DEBUG_UI_ADDR_2_ADDR A:0x6086d038
y.create.l HWIO_QDSS_WRAPPER_DEBUG_UI_ADDR_3_ADDR A:0x6086d03c
y.create.l HWIO_QDSS_WRAPPER_DEBUG_UI_ADDR_4_ADDR A:0x6086d040
y.create.l HWIO_QDSS_WRAPPER_DEBUG_UI_ADDR_5_ADDR A:0x6086d044
y.create.l HWIO_QDSS_WRAPPER_DEBUG_UI_ADDR_6_ADDR A:0x6086d048
y.create.l HWIO_QDSS_WRAPPER_DEBUG_UI_ADDR_7_ADDR A:0x6086d04c
y.create.l HWIO_QDSS_WRAPPER_DEBUG_UI_ADDR_8_ADDR A:0x6086d050
y.create.l HWIO_QDSS_WRAPPER_DEBUG_UI_ADDR_9_ADDR A:0x6086d054
y.create.l HWIO_QDSS_WRAPPER_DEBUG_UI_ADDR_10_ADDR A:0x6086d058
y.create.l HWIO_QDSS_WRAPPER_DEBUG_UI_ADDR_11_ADDR A:0x6086d05c
y.create.l HWIO_QDSS_WRAPPER_DEBUG_UI_ADDR_12_ADDR A:0x6086d060
y.create.l HWIO_QDSS_WRAPPER_DEBUG_UI_ADDR_13_ADDR A:0x6086d064
y.create.l HWIO_QDSS_WRAPPER_DEBUG_UI_ADDR_14_ADDR A:0x6086d068
y.create.l HWIO_QDSS_WRAPPER_DEBUG_UI_ADDR_15_ADDR A:0x6086d06c
y.create.l HWIO_QDSS_WRAPPER_DEBUG_UI_ADDR_16_ADDR A:0x6086d070
y.create.l HWIO_QDSS_WRAPPER_DEBUG_UI_ADDR_17_ADDR A:0x6086d074
y.create.l HWIO_QDSS_WRAPPER_DEBUG_UI_ADDR_18_ADDR A:0x6086d078
y.create.l HWIO_QDSS_WRAPPER_DEBUG_UI_ADDR_19_ADDR A:0x6086d07c
y.create.l HWIO_QDSS_WRAPPER_DEBUG_UI_ADDR_20_ADDR A:0x6086d080
y.create.l HWIO_QDSS_WRAPPER_DEBUG_UI_ADDR_21_ADDR A:0x6086d084
y.create.l HWIO_QDSS_WRAPPER_DEBUG_UI_DATA_0_ADDR A:0x6086d0b0
y.create.l HWIO_QDSS_WRAPPER_DEBUG_UI_DATA_1_ADDR A:0x6086d0b4
y.create.l HWIO_QDSS_WRAPPER_DEBUG_UI_DATA_2_ADDR A:0x6086d0b8
y.create.l HWIO_QDSS_WRAPPER_DEBUG_UI_DATA_3_ADDR A:0x6086d0bc
y.create.l HWIO_QDSS_WRAPPER_DEBUG_UI_DATA_4_ADDR A:0x6086d0c0
y.create.l HWIO_QDSS_WRAPPER_DEBUG_UI_DATA_5_ADDR A:0x6086d0c4
y.create.l HWIO_QDSS_WRAPPER_DEBUG_UI_DATA_6_ADDR A:0x6086d0c8
y.create.l HWIO_QDSS_WRAPPER_DEBUG_UI_DATA_7_ADDR A:0x6086d0cc
y.create.l HWIO_QDSS_WRAPPER_DEBUG_UI_DATA_8_ADDR A:0x6086d0d0
y.create.l HWIO_QDSS_WRAPPER_DEBUG_UI_DATA_9_ADDR A:0x6086d0d4
y.create.l HWIO_QDSS_WRAPPER_CS_DEBUG_UI_ITCTL_ADDR A:0x6086df00
y.create.l HWIO_QDSS_WRAPPER_CS_DEBUG_UI_CLAIMSET_ADDR A:0x6086dfa0
y.create.l HWIO_QDSS_WRAPPER_CS_DEBUG_UI_CLAIMCLR_ADDR A:0x6086dfa4
y.create.l HWIO_QDSS_WRAPPER_CS_DEBUG_UI_LOCKACCESS_ADDR A:0x6086dfb0
y.create.l HWIO_QDSS_WRAPPER_CS_DEBUG_UI_LOCKSTATUS_ADDR A:0x6086dfb4
y.create.l HWIO_QDSS_WRAPPER_CS_DEBUG_UI_AUTHSTATUS_ADDR A:0x6086dfb8
y.create.l HWIO_QDSS_WRAPPER_CS_DEBUG_UI_DEVICEID_ADDR A:0x6086dfc8
y.create.l HWIO_QDSS_WRAPPER_CS_DEBUG_UI_DEVICETYPE_ADDR A:0x6086dfcc
y.create.l HWIO_QDSS_WRAPPER_CS_DEBUG_UI_PERIPHID4_ADDR A:0x6086dfd0
y.create.l HWIO_QDSS_WRAPPER_CS_DEBUG_UI_PERIPHID5_ADDR A:0x6086dfd4
y.create.l HWIO_QDSS_WRAPPER_CS_DEBUG_UI_PERIPHID6_ADDR A:0x6086dfd8
y.create.l HWIO_QDSS_WRAPPER_CS_DEBUG_UI_PERIPHID7_ADDR A:0x6086dfdc
y.create.l HWIO_QDSS_WRAPPER_CS_DEBUG_UI_PERIPHID0_ADDR A:0x6086dfe0
y.create.l HWIO_QDSS_WRAPPER_CS_DEBUG_UI_PERIPHID1_ADDR A:0x6086dfe4
y.create.l HWIO_QDSS_WRAPPER_CS_DEBUG_UI_PERIPHID2_ADDR A:0x6086dfe8
y.create.l HWIO_QDSS_WRAPPER_CS_DEBUG_UI_PERIPHID3_ADDR A:0x6086dfec
y.create.l HWIO_QDSS_WRAPPER_CS_DEBUG_UI_COMPID0_ADDR A:0x6086dff0
y.create.l HWIO_QDSS_WRAPPER_CS_DEBUG_UI_COMPID1_ADDR A:0x6086dff4
y.create.l HWIO_QDSS_WRAPPER_CS_DEBUG_UI_COMPID2_ADDR A:0x6086dff8
y.create.l HWIO_QDSS_WRAPPER_CS_DEBUG_UI_COMPID3_ADDR A:0x6086dffc
y.create.l HWIO_QPIC_QPIC_BAM_CTRL_ADDR A:0x67984000
y.create.l HWIO_QPIC_QPIC_BAM_TIMER_ADDR A:0x67984040
y.create.l HWIO_QPIC_QPIC_BAM_TIMER_CTRL_ADDR A:0x67984044
y.create.l HWIO_QPIC_QPIC_BAM_DESC_CNT_TRSHLD_ADDR A:0x67984008
y.create.l HWIO_QPIC_QPIC_BAM_IRQ_STTS_ADDR A:0x67984014
y.create.l HWIO_QPIC_QPIC_BAM_IRQ_CLR_ADDR A:0x67984018
y.create.l HWIO_QPIC_QPIC_BAM_IRQ_EN_ADDR A:0x6798401c
y.create.l HWIO_QPIC_QPIC_BAM_CNFG_BITS_ADDR A:0x6798407c
y.create.l HWIO_QPIC_QPIC_BAM_REVISION_ADDR A:0x67985000
y.create.l HWIO_QPIC_QPIC_BAM_SW_VERSION_ADDR A:0x67985004
y.create.l HWIO_QPIC_QPIC_BAM_NUM_PIPES_ADDR A:0x67985008
y.create.l HWIO_QPIC_QPIC_BAM_TEST_BUS_SEL_ADDR A:0x67985010
y.create.l HWIO_QPIC_QPIC_BAM_TEST_BUS_REG_ADDR A:0x67985014
y.create.l HWIO_QPIC_QPIC_BAM_AHB_MASTER_ERR_CTRLS_ADDR A:0x67985024
y.create.l HWIO_QPIC_QPIC_BAM_AHB_MASTER_ERR_ADDR_ADDR A:0x67985028
y.create.l HWIO_QPIC_QPIC_BAM_AHB_MASTER_ERR_DATA_ADDR A:0x6798502c
y.create.l HWIO_QPIC_QPIC_BAM_AHB_MASTER_ERR_ADDR_LSB_ADDR A:0x67985100
y.create.l HWIO_QPIC_QPIC_BAM_AHB_MASTER_ERR_ADDR_MSB_ADDR A:0x67985104
y.create.l HWIO_QPIC_QPIC_BAM_TRUST_REG_ADDR A:0x67986000
y.create.l HWIO_QPIC_QPIC_BAM_P_TRUST_REG0_ADDR A:0x67986020
y.create.l HWIO_QPIC_QPIC_BAM_P_TRUST_REG1_ADDR A:0x67986024
y.create.l HWIO_QPIC_QPIC_BAM_P_TRUST_REG2_ADDR A:0x67986028
y.create.l HWIO_QPIC_QPIC_BAM_P_TRUST_REG3_ADDR A:0x6798602c
y.create.l HWIO_QPIC_QPIC_BAM_P_TRUST_REG4_ADDR A:0x67986030
y.create.l HWIO_QPIC_QPIC_BAM_P_TRUST_REG5_ADDR A:0x67986034
y.create.l HWIO_QPIC_QPIC_BAM_P_TRUST_REG6_ADDR A:0x67986038
y.create.l HWIO_QPIC_QPIC_BAM_IRQ_SRCS_EE0_ADDR A:0x67987000
y.create.l HWIO_QPIC_QPIC_BAM_IRQ_SRCS_EE1_ADDR A:0x67988000
y.create.l HWIO_QPIC_QPIC_BAM_IRQ_SRCS_EE2_ADDR A:0x67989000
y.create.l HWIO_QPIC_QPIC_BAM_IRQ_SRCS_EE3_ADDR A:0x6798a000
y.create.l HWIO_QPIC_QPIC_BAM_IRQ_SRCS_EE4_ADDR A:0x6798b000
y.create.l HWIO_QPIC_QPIC_BAM_IRQ_SRCS_EE5_ADDR A:0x6798c000
y.create.l HWIO_QPIC_QPIC_BAM_IRQ_SRCS_EE6_ADDR A:0x6798d000
y.create.l HWIO_QPIC_QPIC_BAM_IRQ_SRCS_EE7_ADDR A:0x6798e000
y.create.l HWIO_QPIC_QPIC_BAM_IRQ_SRCS_MSK_EE0_ADDR A:0x67987004
y.create.l HWIO_QPIC_QPIC_BAM_IRQ_SRCS_MSK_EE1_ADDR A:0x67988004
y.create.l HWIO_QPIC_QPIC_BAM_IRQ_SRCS_MSK_EE2_ADDR A:0x67989004
y.create.l HWIO_QPIC_QPIC_BAM_IRQ_SRCS_MSK_EE3_ADDR A:0x6798a004
y.create.l HWIO_QPIC_QPIC_BAM_IRQ_SRCS_MSK_EE4_ADDR A:0x6798b004
y.create.l HWIO_QPIC_QPIC_BAM_IRQ_SRCS_MSK_EE5_ADDR A:0x6798c004
y.create.l HWIO_QPIC_QPIC_BAM_IRQ_SRCS_MSK_EE6_ADDR A:0x6798d004
y.create.l HWIO_QPIC_QPIC_BAM_IRQ_SRCS_MSK_EE7_ADDR A:0x6798e004
y.create.l HWIO_QPIC_QPIC_BAM_IRQ_SRCS_UNMASKED_EE0_ADDR A:0x67987008
y.create.l HWIO_QPIC_QPIC_BAM_IRQ_SRCS_UNMASKED_EE1_ADDR A:0x67988008
y.create.l HWIO_QPIC_QPIC_BAM_IRQ_SRCS_UNMASKED_EE2_ADDR A:0x67989008
y.create.l HWIO_QPIC_QPIC_BAM_IRQ_SRCS_UNMASKED_EE3_ADDR A:0x6798a008
y.create.l HWIO_QPIC_QPIC_BAM_IRQ_SRCS_UNMASKED_EE4_ADDR A:0x6798b008
y.create.l HWIO_QPIC_QPIC_BAM_IRQ_SRCS_UNMASKED_EE5_ADDR A:0x6798c008
y.create.l HWIO_QPIC_QPIC_BAM_IRQ_SRCS_UNMASKED_EE6_ADDR A:0x6798d008
y.create.l HWIO_QPIC_QPIC_BAM_IRQ_SRCS_UNMASKED_EE7_ADDR A:0x6798e008
y.create.l HWIO_QPIC_QPIC_BAM_PIPE_ATTR_EE0_ADDR A:0x6798700c
y.create.l HWIO_QPIC_QPIC_BAM_PIPE_ATTR_EE1_ADDR A:0x6798800c
y.create.l HWIO_QPIC_QPIC_BAM_PIPE_ATTR_EE2_ADDR A:0x6798900c
y.create.l HWIO_QPIC_QPIC_BAM_PIPE_ATTR_EE3_ADDR A:0x6798a00c
y.create.l HWIO_QPIC_QPIC_BAM_PIPE_ATTR_EE4_ADDR A:0x6798b00c
y.create.l HWIO_QPIC_QPIC_BAM_PIPE_ATTR_EE5_ADDR A:0x6798c00c
y.create.l HWIO_QPIC_QPIC_BAM_PIPE_ATTR_EE6_ADDR A:0x6798d00c
y.create.l HWIO_QPIC_QPIC_BAM_PIPE_ATTR_EE7_ADDR A:0x6798e00c
y.create.l HWIO_QPIC_QPIC_BAM_IRQ_SRCS_ADDR A:0x67987010
y.create.l HWIO_QPIC_QPIC_BAM_IRQ_SRCS_MSK_ADDR A:0x67987014
y.create.l HWIO_QPIC_QPIC_BAM_IRQ_SRCS_UNMASKED_ADDR A:0x67987018
y.create.l HWIO_QPIC_QPIC_BAM_P_CTRL0_ADDR A:0x67997000
y.create.l HWIO_QPIC_QPIC_BAM_P_CTRL1_ADDR A:0x67998000
y.create.l HWIO_QPIC_QPIC_BAM_P_CTRL2_ADDR A:0x67999000
y.create.l HWIO_QPIC_QPIC_BAM_P_CTRL3_ADDR A:0x6799a000
y.create.l HWIO_QPIC_QPIC_BAM_P_CTRL4_ADDR A:0x6799b000
y.create.l HWIO_QPIC_QPIC_BAM_P_CTRL5_ADDR A:0x6799c000
y.create.l HWIO_QPIC_QPIC_BAM_P_CTRL6_ADDR A:0x6799d000
y.create.l HWIO_QPIC_QPIC_BAM_P_RST0_ADDR A:0x67997004
y.create.l HWIO_QPIC_QPIC_BAM_P_RST1_ADDR A:0x67998004
y.create.l HWIO_QPIC_QPIC_BAM_P_RST2_ADDR A:0x67999004
y.create.l HWIO_QPIC_QPIC_BAM_P_RST3_ADDR A:0x6799a004
y.create.l HWIO_QPIC_QPIC_BAM_P_RST4_ADDR A:0x6799b004
y.create.l HWIO_QPIC_QPIC_BAM_P_RST5_ADDR A:0x6799c004
y.create.l HWIO_QPIC_QPIC_BAM_P_RST6_ADDR A:0x6799d004
y.create.l HWIO_QPIC_QPIC_BAM_P_HALT0_ADDR A:0x67997008
y.create.l HWIO_QPIC_QPIC_BAM_P_HALT1_ADDR A:0x67998008
y.create.l HWIO_QPIC_QPIC_BAM_P_HALT2_ADDR A:0x67999008
y.create.l HWIO_QPIC_QPIC_BAM_P_HALT3_ADDR A:0x6799a008
y.create.l HWIO_QPIC_QPIC_BAM_P_HALT4_ADDR A:0x6799b008
y.create.l HWIO_QPIC_QPIC_BAM_P_HALT5_ADDR A:0x6799c008
y.create.l HWIO_QPIC_QPIC_BAM_P_HALT6_ADDR A:0x6799d008
y.create.l HWIO_QPIC_QPIC_BAM_P_IRQ_STTS0_ADDR A:0x67997010
y.create.l HWIO_QPIC_QPIC_BAM_P_IRQ_STTS1_ADDR A:0x67998010
y.create.l HWIO_QPIC_QPIC_BAM_P_IRQ_STTS2_ADDR A:0x67999010
y.create.l HWIO_QPIC_QPIC_BAM_P_IRQ_STTS3_ADDR A:0x6799a010
y.create.l HWIO_QPIC_QPIC_BAM_P_IRQ_STTS4_ADDR A:0x6799b010
y.create.l HWIO_QPIC_QPIC_BAM_P_IRQ_STTS5_ADDR A:0x6799c010
y.create.l HWIO_QPIC_QPIC_BAM_P_IRQ_STTS6_ADDR A:0x6799d010
y.create.l HWIO_QPIC_QPIC_BAM_P_IRQ_CLR0_ADDR A:0x67997014
y.create.l HWIO_QPIC_QPIC_BAM_P_IRQ_CLR1_ADDR A:0x67998014
y.create.l HWIO_QPIC_QPIC_BAM_P_IRQ_CLR2_ADDR A:0x67999014
y.create.l HWIO_QPIC_QPIC_BAM_P_IRQ_CLR3_ADDR A:0x6799a014
y.create.l HWIO_QPIC_QPIC_BAM_P_IRQ_CLR4_ADDR A:0x6799b014
y.create.l HWIO_QPIC_QPIC_BAM_P_IRQ_CLR5_ADDR A:0x6799c014
y.create.l HWIO_QPIC_QPIC_BAM_P_IRQ_CLR6_ADDR A:0x6799d014
y.create.l HWIO_QPIC_QPIC_BAM_P_IRQ_EN0_ADDR A:0x67997018
y.create.l HWIO_QPIC_QPIC_BAM_P_IRQ_EN1_ADDR A:0x67998018
y.create.l HWIO_QPIC_QPIC_BAM_P_IRQ_EN2_ADDR A:0x67999018
y.create.l HWIO_QPIC_QPIC_BAM_P_IRQ_EN3_ADDR A:0x6799a018
y.create.l HWIO_QPIC_QPIC_BAM_P_IRQ_EN4_ADDR A:0x6799b018
y.create.l HWIO_QPIC_QPIC_BAM_P_IRQ_EN5_ADDR A:0x6799c018
y.create.l HWIO_QPIC_QPIC_BAM_P_IRQ_EN6_ADDR A:0x6799d018
y.create.l HWIO_QPIC_QPIC_BAM_P_TIMER0_ADDR A:0x6799701c
y.create.l HWIO_QPIC_QPIC_BAM_P_TIMER1_ADDR A:0x6799801c
y.create.l HWIO_QPIC_QPIC_BAM_P_TIMER2_ADDR A:0x6799901c
y.create.l HWIO_QPIC_QPIC_BAM_P_TIMER3_ADDR A:0x6799a01c
y.create.l HWIO_QPIC_QPIC_BAM_P_TIMER4_ADDR A:0x6799b01c
y.create.l HWIO_QPIC_QPIC_BAM_P_TIMER5_ADDR A:0x6799c01c
y.create.l HWIO_QPIC_QPIC_BAM_P_TIMER6_ADDR A:0x6799d01c
y.create.l HWIO_QPIC_QPIC_BAM_P_TIMER_CTRL0_ADDR A:0x67997020
y.create.l HWIO_QPIC_QPIC_BAM_P_TIMER_CTRL1_ADDR A:0x67998020
y.create.l HWIO_QPIC_QPIC_BAM_P_TIMER_CTRL2_ADDR A:0x67999020
y.create.l HWIO_QPIC_QPIC_BAM_P_TIMER_CTRL3_ADDR A:0x6799a020
y.create.l HWIO_QPIC_QPIC_BAM_P_TIMER_CTRL4_ADDR A:0x6799b020
y.create.l HWIO_QPIC_QPIC_BAM_P_TIMER_CTRL5_ADDR A:0x6799c020
y.create.l HWIO_QPIC_QPIC_BAM_P_TIMER_CTRL6_ADDR A:0x6799d020
y.create.l HWIO_QPIC_QPIC_BAM_P_PRDCR_SDBND0_ADDR A:0x67997024
y.create.l HWIO_QPIC_QPIC_BAM_P_PRDCR_SDBND1_ADDR A:0x67998024
y.create.l HWIO_QPIC_QPIC_BAM_P_PRDCR_SDBND2_ADDR A:0x67999024
y.create.l HWIO_QPIC_QPIC_BAM_P_PRDCR_SDBND3_ADDR A:0x6799a024
y.create.l HWIO_QPIC_QPIC_BAM_P_PRDCR_SDBND4_ADDR A:0x6799b024
y.create.l HWIO_QPIC_QPIC_BAM_P_PRDCR_SDBND5_ADDR A:0x6799c024
y.create.l HWIO_QPIC_QPIC_BAM_P_PRDCR_SDBND6_ADDR A:0x6799d024
y.create.l HWIO_QPIC_QPIC_BAM_P_CNSMR_SDBND0_ADDR A:0x67997028
y.create.l HWIO_QPIC_QPIC_BAM_P_CNSMR_SDBND1_ADDR A:0x67998028
y.create.l HWIO_QPIC_QPIC_BAM_P_CNSMR_SDBND2_ADDR A:0x67999028
y.create.l HWIO_QPIC_QPIC_BAM_P_CNSMR_SDBND3_ADDR A:0x6799a028
y.create.l HWIO_QPIC_QPIC_BAM_P_CNSMR_SDBND4_ADDR A:0x6799b028
y.create.l HWIO_QPIC_QPIC_BAM_P_CNSMR_SDBND5_ADDR A:0x6799c028
y.create.l HWIO_QPIC_QPIC_BAM_P_CNSMR_SDBND6_ADDR A:0x6799d028
y.create.l HWIO_QPIC_QPIC_BAM_P_SW_OFSTS0_ADDR A:0x67997800
y.create.l HWIO_QPIC_QPIC_BAM_P_SW_OFSTS1_ADDR A:0x67998800
y.create.l HWIO_QPIC_QPIC_BAM_P_SW_OFSTS2_ADDR A:0x67999800
y.create.l HWIO_QPIC_QPIC_BAM_P_SW_OFSTS3_ADDR A:0x6799a800
y.create.l HWIO_QPIC_QPIC_BAM_P_SW_OFSTS4_ADDR A:0x6799b800
y.create.l HWIO_QPIC_QPIC_BAM_P_SW_OFSTS5_ADDR A:0x6799c800
y.create.l HWIO_QPIC_QPIC_BAM_P_SW_OFSTS6_ADDR A:0x6799d800
y.create.l HWIO_QPIC_QPIC_BAM_P_AU_PSM_CNTXT_1_0_ADDR A:0x67997804
y.create.l HWIO_QPIC_QPIC_BAM_P_AU_PSM_CNTXT_1_1_ADDR A:0x67998804
y.create.l HWIO_QPIC_QPIC_BAM_P_AU_PSM_CNTXT_1_2_ADDR A:0x67999804
y.create.l HWIO_QPIC_QPIC_BAM_P_AU_PSM_CNTXT_1_3_ADDR A:0x6799a804
y.create.l HWIO_QPIC_QPIC_BAM_P_AU_PSM_CNTXT_1_4_ADDR A:0x6799b804
y.create.l HWIO_QPIC_QPIC_BAM_P_AU_PSM_CNTXT_1_5_ADDR A:0x6799c804
y.create.l HWIO_QPIC_QPIC_BAM_P_AU_PSM_CNTXT_1_6_ADDR A:0x6799d804
y.create.l HWIO_QPIC_QPIC_BAM_P_PSM_CNTXT_2_0_ADDR A:0x67997808
y.create.l HWIO_QPIC_QPIC_BAM_P_PSM_CNTXT_2_1_ADDR A:0x67998808
y.create.l HWIO_QPIC_QPIC_BAM_P_PSM_CNTXT_2_2_ADDR A:0x67999808
y.create.l HWIO_QPIC_QPIC_BAM_P_PSM_CNTXT_2_3_ADDR A:0x6799a808
y.create.l HWIO_QPIC_QPIC_BAM_P_PSM_CNTXT_2_4_ADDR A:0x6799b808
y.create.l HWIO_QPIC_QPIC_BAM_P_PSM_CNTXT_2_5_ADDR A:0x6799c808
y.create.l HWIO_QPIC_QPIC_BAM_P_PSM_CNTXT_2_6_ADDR A:0x6799d808
y.create.l HWIO_QPIC_QPIC_BAM_P_PSM_CNTXT_3_0_ADDR A:0x6799780c
y.create.l HWIO_QPIC_QPIC_BAM_P_PSM_CNTXT_3_1_ADDR A:0x6799880c
y.create.l HWIO_QPIC_QPIC_BAM_P_PSM_CNTXT_3_2_ADDR A:0x6799980c
y.create.l HWIO_QPIC_QPIC_BAM_P_PSM_CNTXT_3_3_ADDR A:0x6799a80c
y.create.l HWIO_QPIC_QPIC_BAM_P_PSM_CNTXT_3_4_ADDR A:0x6799b80c
y.create.l HWIO_QPIC_QPIC_BAM_P_PSM_CNTXT_3_5_ADDR A:0x6799c80c
y.create.l HWIO_QPIC_QPIC_BAM_P_PSM_CNTXT_3_6_ADDR A:0x6799d80c
y.create.l HWIO_QPIC_QPIC_BAM_P_PSM_CNTXT_4_0_ADDR A:0x67997810
y.create.l HWIO_QPIC_QPIC_BAM_P_PSM_CNTXT_4_1_ADDR A:0x67998810
y.create.l HWIO_QPIC_QPIC_BAM_P_PSM_CNTXT_4_2_ADDR A:0x67999810
y.create.l HWIO_QPIC_QPIC_BAM_P_PSM_CNTXT_4_3_ADDR A:0x6799a810
y.create.l HWIO_QPIC_QPIC_BAM_P_PSM_CNTXT_4_4_ADDR A:0x6799b810
y.create.l HWIO_QPIC_QPIC_BAM_P_PSM_CNTXT_4_5_ADDR A:0x6799c810
y.create.l HWIO_QPIC_QPIC_BAM_P_PSM_CNTXT_4_6_ADDR A:0x6799d810
y.create.l HWIO_QPIC_QPIC_BAM_P_PSM_CNTXT_5_0_ADDR A:0x67997814
y.create.l HWIO_QPIC_QPIC_BAM_P_PSM_CNTXT_5_1_ADDR A:0x67998814
y.create.l HWIO_QPIC_QPIC_BAM_P_PSM_CNTXT_5_2_ADDR A:0x67999814
y.create.l HWIO_QPIC_QPIC_BAM_P_PSM_CNTXT_5_3_ADDR A:0x6799a814
y.create.l HWIO_QPIC_QPIC_BAM_P_PSM_CNTXT_5_4_ADDR A:0x6799b814
y.create.l HWIO_QPIC_QPIC_BAM_P_PSM_CNTXT_5_5_ADDR A:0x6799c814
y.create.l HWIO_QPIC_QPIC_BAM_P_PSM_CNTXT_5_6_ADDR A:0x6799d814
y.create.l HWIO_QPIC_QPIC_BAM_P_EVNT_REG0_ADDR A:0x67997818
y.create.l HWIO_QPIC_QPIC_BAM_P_EVNT_REG1_ADDR A:0x67998818
y.create.l HWIO_QPIC_QPIC_BAM_P_EVNT_REG2_ADDR A:0x67999818
y.create.l HWIO_QPIC_QPIC_BAM_P_EVNT_REG3_ADDR A:0x6799a818
y.create.l HWIO_QPIC_QPIC_BAM_P_EVNT_REG4_ADDR A:0x6799b818
y.create.l HWIO_QPIC_QPIC_BAM_P_EVNT_REG5_ADDR A:0x6799c818
y.create.l HWIO_QPIC_QPIC_BAM_P_EVNT_REG6_ADDR A:0x6799d818
y.create.l HWIO_QPIC_QPIC_BAM_P_DESC_FIFO_ADDR0_ADDR A:0x6799781c
y.create.l HWIO_QPIC_QPIC_BAM_P_DESC_FIFO_ADDR1_ADDR A:0x6799881c
y.create.l HWIO_QPIC_QPIC_BAM_P_DESC_FIFO_ADDR2_ADDR A:0x6799981c
y.create.l HWIO_QPIC_QPIC_BAM_P_DESC_FIFO_ADDR3_ADDR A:0x6799a81c
y.create.l HWIO_QPIC_QPIC_BAM_P_DESC_FIFO_ADDR4_ADDR A:0x6799b81c
y.create.l HWIO_QPIC_QPIC_BAM_P_DESC_FIFO_ADDR5_ADDR A:0x6799c81c
y.create.l HWIO_QPIC_QPIC_BAM_P_DESC_FIFO_ADDR6_ADDR A:0x6799d81c
y.create.l HWIO_QPIC_QPIC_BAM_P_FIFO_SIZES0_ADDR A:0x67997820
y.create.l HWIO_QPIC_QPIC_BAM_P_FIFO_SIZES1_ADDR A:0x67998820
y.create.l HWIO_QPIC_QPIC_BAM_P_FIFO_SIZES2_ADDR A:0x67999820
y.create.l HWIO_QPIC_QPIC_BAM_P_FIFO_SIZES3_ADDR A:0x6799a820
y.create.l HWIO_QPIC_QPIC_BAM_P_FIFO_SIZES4_ADDR A:0x6799b820
y.create.l HWIO_QPIC_QPIC_BAM_P_FIFO_SIZES5_ADDR A:0x6799c820
y.create.l HWIO_QPIC_QPIC_BAM_P_FIFO_SIZES6_ADDR A:0x6799d820
y.create.l HWIO_QPIC_QPIC_BAM_P_DATA_FIFO_ADDR0_ADDR A:0x67997824
y.create.l HWIO_QPIC_QPIC_BAM_P_DATA_FIFO_ADDR1_ADDR A:0x67998824
y.create.l HWIO_QPIC_QPIC_BAM_P_DATA_FIFO_ADDR2_ADDR A:0x67999824
y.create.l HWIO_QPIC_QPIC_BAM_P_DATA_FIFO_ADDR3_ADDR A:0x6799a824
y.create.l HWIO_QPIC_QPIC_BAM_P_DATA_FIFO_ADDR4_ADDR A:0x6799b824
y.create.l HWIO_QPIC_QPIC_BAM_P_DATA_FIFO_ADDR5_ADDR A:0x6799c824
y.create.l HWIO_QPIC_QPIC_BAM_P_DATA_FIFO_ADDR6_ADDR A:0x6799d824
y.create.l HWIO_QPIC_QPIC_BAM_P_EVNT_GEN_TRSHLD0_ADDR A:0x67997828
y.create.l HWIO_QPIC_QPIC_BAM_P_EVNT_GEN_TRSHLD1_ADDR A:0x67998828
y.create.l HWIO_QPIC_QPIC_BAM_P_EVNT_GEN_TRSHLD2_ADDR A:0x67999828
y.create.l HWIO_QPIC_QPIC_BAM_P_EVNT_GEN_TRSHLD3_ADDR A:0x6799a828
y.create.l HWIO_QPIC_QPIC_BAM_P_EVNT_GEN_TRSHLD4_ADDR A:0x6799b828
y.create.l HWIO_QPIC_QPIC_BAM_P_EVNT_GEN_TRSHLD5_ADDR A:0x6799c828
y.create.l HWIO_QPIC_QPIC_BAM_P_EVNT_GEN_TRSHLD6_ADDR A:0x6799d828
y.create.l HWIO_QPIC_QPIC_BAM_P_EVNT_DEST_ADDR0_ADDR A:0x6799782c
y.create.l HWIO_QPIC_QPIC_BAM_P_EVNT_DEST_ADDR1_ADDR A:0x6799882c
y.create.l HWIO_QPIC_QPIC_BAM_P_EVNT_DEST_ADDR2_ADDR A:0x6799982c
y.create.l HWIO_QPIC_QPIC_BAM_P_EVNT_DEST_ADDR3_ADDR A:0x6799a82c
y.create.l HWIO_QPIC_QPIC_BAM_P_EVNT_DEST_ADDR4_ADDR A:0x6799b82c
y.create.l HWIO_QPIC_QPIC_BAM_P_EVNT_DEST_ADDR5_ADDR A:0x6799c82c
y.create.l HWIO_QPIC_QPIC_BAM_P_EVNT_DEST_ADDR6_ADDR A:0x6799d82c
y.create.l HWIO_QPIC_QPIC_BAM_P_DF_CNTXT_0_ADDR A:0x67997830
y.create.l HWIO_QPIC_QPIC_BAM_P_DF_CNTXT_1_ADDR A:0x67998830
y.create.l HWIO_QPIC_QPIC_BAM_P_DF_CNTXT_2_ADDR A:0x67999830
y.create.l HWIO_QPIC_QPIC_BAM_P_DF_CNTXT_3_ADDR A:0x6799a830
y.create.l HWIO_QPIC_QPIC_BAM_P_DF_CNTXT_4_ADDR A:0x6799b830
y.create.l HWIO_QPIC_QPIC_BAM_P_DF_CNTXT_5_ADDR A:0x6799c830
y.create.l HWIO_QPIC_QPIC_BAM_P_DF_CNTXT_6_ADDR A:0x6799d830
y.create.l HWIO_QPIC_QPIC_BAM_P_RETR_CNTXT_0_ADDR A:0x67997834
y.create.l HWIO_QPIC_QPIC_BAM_P_RETR_CNTXT_1_ADDR A:0x67998834
y.create.l HWIO_QPIC_QPIC_BAM_P_RETR_CNTXT_2_ADDR A:0x67999834
y.create.l HWIO_QPIC_QPIC_BAM_P_RETR_CNTXT_3_ADDR A:0x6799a834
y.create.l HWIO_QPIC_QPIC_BAM_P_RETR_CNTXT_4_ADDR A:0x6799b834
y.create.l HWIO_QPIC_QPIC_BAM_P_RETR_CNTXT_5_ADDR A:0x6799c834
y.create.l HWIO_QPIC_QPIC_BAM_P_RETR_CNTXT_6_ADDR A:0x6799d834
y.create.l HWIO_QPIC_QPIC_BAM_P_SI_CNTXT_0_ADDR A:0x67997838
y.create.l HWIO_QPIC_QPIC_BAM_P_SI_CNTXT_1_ADDR A:0x67998838
y.create.l HWIO_QPIC_QPIC_BAM_P_SI_CNTXT_2_ADDR A:0x67999838
y.create.l HWIO_QPIC_QPIC_BAM_P_SI_CNTXT_3_ADDR A:0x6799a838
y.create.l HWIO_QPIC_QPIC_BAM_P_SI_CNTXT_4_ADDR A:0x6799b838
y.create.l HWIO_QPIC_QPIC_BAM_P_SI_CNTXT_5_ADDR A:0x6799c838
y.create.l HWIO_QPIC_QPIC_BAM_P_SI_CNTXT_6_ADDR A:0x6799d838
y.create.l HWIO_QPIC_QPIC_BAM_P_PSM_CNTXT_3_LSB0_ADDR A:0x67997900
y.create.l HWIO_QPIC_QPIC_BAM_P_PSM_CNTXT_3_LSB1_ADDR A:0x67998900
y.create.l HWIO_QPIC_QPIC_BAM_P_PSM_CNTXT_3_LSB2_ADDR A:0x67999900
y.create.l HWIO_QPIC_QPIC_BAM_P_PSM_CNTXT_3_LSB3_ADDR A:0x6799a900
y.create.l HWIO_QPIC_QPIC_BAM_P_PSM_CNTXT_3_LSB4_ADDR A:0x6799b900
y.create.l HWIO_QPIC_QPIC_BAM_P_PSM_CNTXT_3_LSB5_ADDR A:0x6799c900
y.create.l HWIO_QPIC_QPIC_BAM_P_PSM_CNTXT_3_LSB6_ADDR A:0x6799d900
y.create.l HWIO_QPIC_QPIC_BAM_P_PSM_CNTXT_3_MSB0_ADDR A:0x67997904
y.create.l HWIO_QPIC_QPIC_BAM_P_PSM_CNTXT_3_MSB1_ADDR A:0x67998904
y.create.l HWIO_QPIC_QPIC_BAM_P_PSM_CNTXT_3_MSB2_ADDR A:0x67999904
y.create.l HWIO_QPIC_QPIC_BAM_P_PSM_CNTXT_3_MSB3_ADDR A:0x6799a904
y.create.l HWIO_QPIC_QPIC_BAM_P_PSM_CNTXT_3_MSB4_ADDR A:0x6799b904
y.create.l HWIO_QPIC_QPIC_BAM_P_PSM_CNTXT_3_MSB5_ADDR A:0x6799c904
y.create.l HWIO_QPIC_QPIC_BAM_P_PSM_CNTXT_3_MSB6_ADDR A:0x6799d904
y.create.l HWIO_QPIC_QPIC_BAM_P_DESC_FIFO_ADDR_LSB0_ADDR A:0x67997910
y.create.l HWIO_QPIC_QPIC_BAM_P_DESC_FIFO_ADDR_LSB1_ADDR A:0x67998910
y.create.l HWIO_QPIC_QPIC_BAM_P_DESC_FIFO_ADDR_LSB2_ADDR A:0x67999910
y.create.l HWIO_QPIC_QPIC_BAM_P_DESC_FIFO_ADDR_LSB3_ADDR A:0x6799a910
y.create.l HWIO_QPIC_QPIC_BAM_P_DESC_FIFO_ADDR_LSB4_ADDR A:0x6799b910
y.create.l HWIO_QPIC_QPIC_BAM_P_DESC_FIFO_ADDR_LSB5_ADDR A:0x6799c910
y.create.l HWIO_QPIC_QPIC_BAM_P_DESC_FIFO_ADDR_LSB6_ADDR A:0x6799d910
y.create.l HWIO_QPIC_QPIC_BAM_P_DESC_FIFO_ADDR_MSB0_ADDR A:0x67997914
y.create.l HWIO_QPIC_QPIC_BAM_P_DESC_FIFO_ADDR_MSB1_ADDR A:0x67998914
y.create.l HWIO_QPIC_QPIC_BAM_P_DESC_FIFO_ADDR_MSB2_ADDR A:0x67999914
y.create.l HWIO_QPIC_QPIC_BAM_P_DESC_FIFO_ADDR_MSB3_ADDR A:0x6799a914
y.create.l HWIO_QPIC_QPIC_BAM_P_DESC_FIFO_ADDR_MSB4_ADDR A:0x6799b914
y.create.l HWIO_QPIC_QPIC_BAM_P_DESC_FIFO_ADDR_MSB5_ADDR A:0x6799c914
y.create.l HWIO_QPIC_QPIC_BAM_P_DESC_FIFO_ADDR_MSB6_ADDR A:0x6799d914
y.create.l HWIO_QPIC_QPIC_BAM_P_DATA_FIFO_ADDR_LSB0_ADDR A:0x67997920
y.create.l HWIO_QPIC_QPIC_BAM_P_DATA_FIFO_ADDR_LSB1_ADDR A:0x67998920
y.create.l HWIO_QPIC_QPIC_BAM_P_DATA_FIFO_ADDR_LSB2_ADDR A:0x67999920
y.create.l HWIO_QPIC_QPIC_BAM_P_DATA_FIFO_ADDR_LSB3_ADDR A:0x6799a920
y.create.l HWIO_QPIC_QPIC_BAM_P_DATA_FIFO_ADDR_LSB4_ADDR A:0x6799b920
y.create.l HWIO_QPIC_QPIC_BAM_P_DATA_FIFO_ADDR_LSB5_ADDR A:0x6799c920
y.create.l HWIO_QPIC_QPIC_BAM_P_DATA_FIFO_ADDR_LSB6_ADDR A:0x6799d920
y.create.l HWIO_QPIC_QPIC_BAM_P_DATA_FIFO_ADDR_MSB0_ADDR A:0x67997924
y.create.l HWIO_QPIC_QPIC_BAM_P_DATA_FIFO_ADDR_MSB1_ADDR A:0x67998924
y.create.l HWIO_QPIC_QPIC_BAM_P_DATA_FIFO_ADDR_MSB2_ADDR A:0x67999924
y.create.l HWIO_QPIC_QPIC_BAM_P_DATA_FIFO_ADDR_MSB3_ADDR A:0x6799a924
y.create.l HWIO_QPIC_QPIC_BAM_P_DATA_FIFO_ADDR_MSB4_ADDR A:0x6799b924
y.create.l HWIO_QPIC_QPIC_BAM_P_DATA_FIFO_ADDR_MSB5_ADDR A:0x6799c924
y.create.l HWIO_QPIC_QPIC_BAM_P_DATA_FIFO_ADDR_MSB6_ADDR A:0x6799d924
y.create.l HWIO_QPIC_QPIC_BAM_P_EVNT_DEST_ADDR_LSB0_ADDR A:0x67997930
y.create.l HWIO_QPIC_QPIC_BAM_P_EVNT_DEST_ADDR_LSB1_ADDR A:0x67998930
y.create.l HWIO_QPIC_QPIC_BAM_P_EVNT_DEST_ADDR_LSB2_ADDR A:0x67999930
y.create.l HWIO_QPIC_QPIC_BAM_P_EVNT_DEST_ADDR_LSB3_ADDR A:0x6799a930
y.create.l HWIO_QPIC_QPIC_BAM_P_EVNT_DEST_ADDR_LSB4_ADDR A:0x6799b930
y.create.l HWIO_QPIC_QPIC_BAM_P_EVNT_DEST_ADDR_LSB5_ADDR A:0x6799c930
y.create.l HWIO_QPIC_QPIC_BAM_P_EVNT_DEST_ADDR_LSB6_ADDR A:0x6799d930
y.create.l HWIO_QPIC_QPIC_BAM_P_EVNT_DEST_ADDR_MSB0_ADDR A:0x67997934
y.create.l HWIO_QPIC_QPIC_BAM_P_EVNT_DEST_ADDR_MSB1_ADDR A:0x67998934
y.create.l HWIO_QPIC_QPIC_BAM_P_EVNT_DEST_ADDR_MSB2_ADDR A:0x67999934
y.create.l HWIO_QPIC_QPIC_BAM_P_EVNT_DEST_ADDR_MSB3_ADDR A:0x6799a934
y.create.l HWIO_QPIC_QPIC_BAM_P_EVNT_DEST_ADDR_MSB4_ADDR A:0x6799b934
y.create.l HWIO_QPIC_QPIC_BAM_P_EVNT_DEST_ADDR_MSB5_ADDR A:0x6799c934
y.create.l HWIO_QPIC_QPIC_BAM_P_EVNT_DEST_ADDR_MSB6_ADDR A:0x6799d934
y.create.l HWIO_QPIC_QPIC_XPU_SCR_ADDR A:0x67982000
y.create.l HWIO_QPIC_QPIC_XPU_SWDR_ADDR A:0x67982004
y.create.l HWIO_QPIC_QPIC_XPU_SEAR0_ADDR A:0x67982040
y.create.l HWIO_QPIC_QPIC_XPU_SESR_ADDR A:0x67982048
y.create.l HWIO_QPIC_QPIC_XPU_SESRRESTORE_ADDR A:0x6798204c
y.create.l HWIO_QPIC_QPIC_XPU_SESYNR0_ADDR A:0x67982050
y.create.l HWIO_QPIC_QPIC_XPU_SESYNR1_ADDR A:0x67982054
y.create.l HWIO_QPIC_QPIC_XPU_SESYNR2_ADDR A:0x67982058
y.create.l HWIO_QPIC_QPIC_XPU_MCR_ADDR A:0x67982100
y.create.l HWIO_QPIC_QPIC_XPU_MEAR0_ADDR A:0x67982140
y.create.l HWIO_QPIC_QPIC_XPU_MESR_ADDR A:0x67982148
y.create.l HWIO_QPIC_QPIC_XPU_MESRRESTORE_ADDR A:0x6798214c
y.create.l HWIO_QPIC_QPIC_XPU_MESYNR0_ADDR A:0x67982150
y.create.l HWIO_QPIC_QPIC_XPU_MESYNR1_ADDR A:0x67982154
y.create.l HWIO_QPIC_QPIC_XPU_MESYNR2_ADDR A:0x67982158
y.create.l HWIO_QPIC_QPIC_XPU_CR_ADDR A:0x67982080
y.create.l HWIO_QPIC_QPIC_XPU_RPU_ACR0_ADDR A:0x679820a0
y.create.l HWIO_QPIC_QPIC_XPU_EAR0_ADDR A:0x679820c0
y.create.l HWIO_QPIC_QPIC_XPU_ESR_ADDR A:0x679820c8
y.create.l HWIO_QPIC_QPIC_XPU_ESRRESTORE_ADDR A:0x679820cc
y.create.l HWIO_QPIC_QPIC_XPU_ESYNR0_ADDR A:0x679820d0
y.create.l HWIO_QPIC_QPIC_XPU_ESYNR1_ADDR A:0x679820d4
y.create.l HWIO_QPIC_QPIC_XPU_ESYNR2_ADDR A:0x679820d8
y.create.l HWIO_QPIC_QPIC_XPU_IDR0_ADDR A:0x67982074
y.create.l HWIO_QPIC_QPIC_XPU_IDR1_ADDR A:0x67982078
y.create.l HWIO_QPIC_QPIC_XPU_REV_ADDR A:0x6798207c
y.create.l HWIO_QPIC_QPIC_XPU_RG0_RACR0_ADDR A:0x67982200
y.create.l HWIO_QPIC_QPIC_XPU_RG1_RACR0_ADDR A:0x67982280
y.create.l HWIO_QPIC_QPIC_XPU_RG2_RACR0_ADDR A:0x67982300
y.create.l HWIO_QPIC_QPIC_XPU_RG3_RACR0_ADDR A:0x67982380
y.create.l HWIO_QPIC_QPIC_XPU_RG4_RACR0_ADDR A:0x67982400
y.create.l HWIO_QPIC_QPIC_XPU_RG5_RACR0_ADDR A:0x67982480
y.create.l HWIO_QPIC_QPIC_XPU_RG6_RACR0_ADDR A:0x67982500
y.create.l HWIO_QPIC_QPIC_XPU_RG7_RACR0_ADDR A:0x67982580
y.create.l HWIO_QPIC_QPIC_XPU_RG8_RACR0_ADDR A:0x67982600
y.create.l HWIO_QPIC_QPIC_XPU_RG9_RACR0_ADDR A:0x67982680
y.create.l HWIO_QPIC_QPIC_XPU_RG0_SCR_ADDR A:0x67982250
y.create.l HWIO_QPIC_QPIC_XPU_RG1_SCR_ADDR A:0x679822d0
y.create.l HWIO_QPIC_QPIC_XPU_RG2_SCR_ADDR A:0x67982350
y.create.l HWIO_QPIC_QPIC_XPU_RG3_SCR_ADDR A:0x679823d0
y.create.l HWIO_QPIC_QPIC_XPU_RG4_SCR_ADDR A:0x67982450
y.create.l HWIO_QPIC_QPIC_XPU_RG5_SCR_ADDR A:0x679824d0
y.create.l HWIO_QPIC_QPIC_XPU_RG6_SCR_ADDR A:0x67982550
y.create.l HWIO_QPIC_QPIC_XPU_RG7_SCR_ADDR A:0x679825d0
y.create.l HWIO_QPIC_QPIC_XPU_RG8_SCR_ADDR A:0x67982650
y.create.l HWIO_QPIC_QPIC_XPU_RG9_SCR_ADDR A:0x679826d0
y.create.l HWIO_QPIC_QPIC_XPU_RG0_MCR_ADDR A:0x67982254
y.create.l HWIO_QPIC_QPIC_XPU_RG1_MCR_ADDR A:0x679822d4
y.create.l HWIO_QPIC_QPIC_XPU_RG2_MCR_ADDR A:0x67982354
y.create.l HWIO_QPIC_QPIC_XPU_RG3_MCR_ADDR A:0x679823d4
y.create.l HWIO_QPIC_QPIC_XPU_RG4_MCR_ADDR A:0x67982454
y.create.l HWIO_QPIC_QPIC_XPU_RG5_MCR_ADDR A:0x679824d4
y.create.l HWIO_QPIC_QPIC_XPU_RG6_MCR_ADDR A:0x67982554
y.create.l HWIO_QPIC_QPIC_XPU_RG7_MCR_ADDR A:0x679825d4
y.create.l HWIO_QPIC_QPIC_XPU_RG8_MCR_ADDR A:0x67982654
y.create.l HWIO_QPIC_QPIC_XPU_RG9_MCR_ADDR A:0x679826d4
y.create.l HWIO_QPIC_QPIC_VMIDMT_SCR0_ADDR A:0x67980000
y.create.l HWIO_QPIC_QPIC_VMIDMT_SCR1_ADDR A:0x67980004
y.create.l HWIO_QPIC_QPIC_VMIDMT_SCR2_ADDR A:0x67980008
y.create.l HWIO_QPIC_QPIC_VMIDMT_SACR_ADDR A:0x67980010
y.create.l HWIO_QPIC_QPIC_VMIDMT_SIDR0_ADDR A:0x67980020
y.create.l HWIO_QPIC_QPIC_VMIDMT_SIDR1_ADDR A:0x67980024
y.create.l HWIO_QPIC_QPIC_VMIDMT_SIDR2_ADDR A:0x67980028
y.create.l HWIO_QPIC_QPIC_VMIDMT_SIDR4_ADDR A:0x67980030
y.create.l HWIO_QPIC_QPIC_VMIDMT_SIDR5_ADDR A:0x67980034
y.create.l HWIO_QPIC_QPIC_VMIDMT_SIDR7_ADDR A:0x6798003c
y.create.l HWIO_QPIC_QPIC_VMIDMT_SGFAR0_ADDR A:0x67980040
y.create.l HWIO_QPIC_QPIC_VMIDMT_SGFSR_ADDR A:0x67980048
y.create.l HWIO_QPIC_QPIC_VMIDMT_SGFSRRESTORE_ADDR A:0x6798004c
y.create.l HWIO_QPIC_QPIC_VMIDMT_SGFSYNDR0_ADDR A:0x67980050
y.create.l HWIO_QPIC_QPIC_VMIDMT_SGFSYNDR1_ADDR A:0x67980054
y.create.l HWIO_QPIC_QPIC_VMIDMT_SGFSYNDR2_ADDR A:0x67980058
y.create.l HWIO_QPIC_QPIC_VMIDMT_VMIDMTSCR0_ADDR A:0x67980090
y.create.l HWIO_QPIC_QPIC_VMIDMT_CR0_ADDR A:0x67980000
y.create.l HWIO_QPIC_QPIC_VMIDMT_CR2_ADDR A:0x67980008
y.create.l HWIO_QPIC_QPIC_VMIDMT_ACR_ADDR A:0x67980010
y.create.l HWIO_QPIC_QPIC_VMIDMT_IDR0_ADDR A:0x67980020
y.create.l HWIO_QPIC_QPIC_VMIDMT_IDR1_ADDR A:0x67980024
y.create.l HWIO_QPIC_QPIC_VMIDMT_IDR2_ADDR A:0x67980028
y.create.l HWIO_QPIC_QPIC_VMIDMT_IDR4_ADDR A:0x67980030
y.create.l HWIO_QPIC_QPIC_VMIDMT_IDR5_ADDR A:0x67980034
y.create.l HWIO_QPIC_QPIC_VMIDMT_IDR7_ADDR A:0x6798003c
y.create.l HWIO_QPIC_QPIC_VMIDMT_GFAR0_ADDR A:0x67980040
y.create.l HWIO_QPIC_QPIC_VMIDMT_GFSR_ADDR A:0x67980048
y.create.l HWIO_QPIC_QPIC_VMIDMT_GFSRRESTORE_ADDR A:0x6798004c
y.create.l HWIO_QPIC_QPIC_VMIDMT_GFSYNDR0_ADDR A:0x67980050
y.create.l HWIO_QPIC_QPIC_VMIDMT_GFSYNDR1_ADDR A:0x67980054
y.create.l HWIO_QPIC_QPIC_VMIDMT_GFSYNDR2_ADDR A:0x67980058
y.create.l HWIO_QPIC_QPIC_VMIDMT_VMIDMTCR0_ADDR A:0x67980090
y.create.l HWIO_QPIC_QPIC_VMIDMT_VMIDMTACR_ADDR A:0x6798009c
y.create.l HWIO_QPIC_QPIC_VMIDMT_NSCR0_ADDR A:0x67980400
y.create.l HWIO_QPIC_QPIC_VMIDMT_NSCR2_ADDR A:0x67980408
y.create.l HWIO_QPIC_QPIC_VMIDMT_NSACR_ADDR A:0x67980410
y.create.l HWIO_QPIC_QPIC_VMIDMT_NSGFAR0_ADDR A:0x67980440
y.create.l HWIO_QPIC_QPIC_VMIDMT_NSGFSR_ADDR A:0x67980448
y.create.l HWIO_QPIC_QPIC_VMIDMT_NSGFSRRESTORE_ADDR A:0x6798044c
y.create.l HWIO_QPIC_QPIC_VMIDMT_NSGFSYNDR0_ADDR A:0x67980450
y.create.l HWIO_QPIC_QPIC_VMIDMT_NSGFSYNDR1_ADDR A:0x67980454
y.create.l HWIO_QPIC_QPIC_VMIDMT_NSGFSYNDR2_ADDR A:0x67980458
y.create.l HWIO_QPIC_QPIC_VMIDMT_NSVMIDMTCR0_ADDR A:0x67980490
y.create.l HWIO_QPIC_QPIC_VMIDMT_SSDR0_ADDR A:0x67980080
y.create.l HWIO_QPIC_QPIC_VMIDMT_MSDR0_ADDR A:0x67980480
y.create.l HWIO_QPIC_QPIC_VMIDMT_MCR_ADDR A:0x67980494
y.create.l HWIO_QPIC_QPIC_VMIDMT_S2VR0_ADDR A:0x67980c00
y.create.l HWIO_QPIC_QPIC_VMIDMT_S2VR1_ADDR A:0x67980c04
y.create.l HWIO_QPIC_QPIC_VMIDMT_S2VR2_ADDR A:0x67980c08
y.create.l HWIO_QPIC_QPIC_VMIDMT_S2VR3_ADDR A:0x67980c0c
y.create.l HWIO_QPIC_QPIC_VMIDMT_S2VR4_ADDR A:0x67980c10
y.create.l HWIO_QPIC_QPIC_VMIDMT_S2VR5_ADDR A:0x67980c14
y.create.l HWIO_QPIC_QPIC_VMIDMT_S2VR6_ADDR A:0x67980c18
y.create.l HWIO_QPIC_QPIC_VMIDMT_S2VR7_ADDR A:0x67980c1c
y.create.l HWIO_QPIC_QPIC_VMIDMT_AS2VR0_ADDR A:0x67980e00
y.create.l HWIO_QPIC_QPIC_VMIDMT_AS2VR1_ADDR A:0x67980e04
y.create.l HWIO_QPIC_QPIC_VMIDMT_AS2VR2_ADDR A:0x67980e08
y.create.l HWIO_QPIC_QPIC_VMIDMT_AS2VR3_ADDR A:0x67980e0c
y.create.l HWIO_QPIC_QPIC_VMIDMT_AS2VR4_ADDR A:0x67980e10
y.create.l HWIO_QPIC_QPIC_VMIDMT_AS2VR5_ADDR A:0x67980e14
y.create.l HWIO_QPIC_QPIC_VMIDMT_AS2VR6_ADDR A:0x67980e18
y.create.l HWIO_QPIC_QPIC_VMIDMT_AS2VR7_ADDR A:0x67980e1c
y.create.l HWIO_QPIC_QPIC_VMIDMT_SMR0_ADDR A:0x67980800
y.create.l HWIO_QPIC_QPIC_VMIDMT_SMR1_ADDR A:0x67980804
y.create.l HWIO_QPIC_QPIC_VMIDMT_SMR2_ADDR A:0x67980808
y.create.l HWIO_QPIC_QPIC_VMIDMT_SMR3_ADDR A:0x6798080c
y.create.l HWIO_QPIC_QPIC_VMIDMT_SMR4_ADDR A:0x67980810
y.create.l HWIO_QPIC_QPIC_VMIDMT_SMR5_ADDR A:0x67980814
y.create.l HWIO_QPIC_QPIC_VMIDMT_SMR6_ADDR A:0x67980818
y.create.l HWIO_QPIC_QPIC_VMIDMT_SMR7_ADDR A:0x6798081c
y.create.l HWIO_QPIC_EBI2_CHIP_SELECT_CFG0_ADDR A:0x679a0000
y.create.l HWIO_QPIC_EBI2_CFG_ADDR A:0x679a0004
y.create.l HWIO_QPIC_EBI2_ARBITER_CFG_ADDR A:0x679a0030
y.create.l HWIO_QPIC_EBI2_DEBUG_REG_LSB_ADDR A:0x679a0048
y.create.l HWIO_QPIC_EBI2_DEBUG_REG_MSB_ADDR A:0x679a004c
y.create.l HWIO_QPIC_EBI2_DEBUG_SEL_ADDR A:0x679a0050
y.create.l HWIO_QPIC_EBI2_CRC_CFG_ADDR A:0x679a0054
y.create.l HWIO_QPIC_EBI2_CRC_REMINDER_CFG_ADDR A:0x679a0058
y.create.l HWIO_QPIC_EBI2_NAND_ADM_MUX_ADDR A:0x679a005c
y.create.l HWIO_QPIC_EBI2_CLKON_CFG_ADDR A:0x679a0068
y.create.l HWIO_QPIC_EBI2_CORE_CLKON_CFG_ADDR A:0x679a006c
y.create.l HWIO_QPIC_QPIC_LCDC_CTRL_ADDR A:0x679a2000
y.create.l HWIO_QPIC_LCDC_VERSION_ADDR A:0x679a2004
y.create.l HWIO_QPIC_QPIC_LCDC_IRQ_EN_ADDR A:0x679a2008
y.create.l HWIO_QPIC_QPIC_LCDC_IRQ_STTS_ADDR A:0x679a200c
y.create.l HWIO_QPIC_QPIC_LCDC_IRQ_CLR_ADDR A:0x679a2010
y.create.l HWIO_QPIC_QPIC_LCDC_STTS_ADDR A:0x679a2014
y.create.l HWIO_QPIC_QPIC_LCDC_CMD_DATA_CYCLE_CNT_ADDR A:0x679a2018
y.create.l HWIO_QPIC_QPIC_LCDC_CFG0_ADDR A:0x679a2020
y.create.l HWIO_QPIC_QPIC_LCDC_CFG1_ADDR A:0x679a2024
y.create.l HWIO_QPIC_QPIC_LCDC_CFG2_ADDR A:0x679a2028
y.create.l HWIO_QPIC_QPIC_LCDC_RESET_ADDR A:0x679a202c
y.create.l HWIO_QPIC_QPIC_LCD_DEVICE_RESET_ADDR A:0x679a2030
y.create.l HWIO_QPIC_QPIC_LCDC_FIFO_SOF_ADDR A:0x679a2100
y.create.l HWIO_QPIC_QPIC_LCDC_FIFO_DATA_PORT0_ADDR A:0x679a2140
y.create.l HWIO_QPIC_QPIC_LCDC_FIFO_DATA_PORT1_ADDR A:0x679a2144
y.create.l HWIO_QPIC_QPIC_LCDC_FIFO_DATA_PORT2_ADDR A:0x679a2148
y.create.l HWIO_QPIC_QPIC_LCDC_FIFO_DATA_PORT3_ADDR A:0x679a214c
y.create.l HWIO_QPIC_QPIC_LCDC_FIFO_DATA_PORT4_ADDR A:0x679a2150
y.create.l HWIO_QPIC_QPIC_LCDC_FIFO_DATA_PORT5_ADDR A:0x679a2154
y.create.l HWIO_QPIC_QPIC_LCDC_FIFO_DATA_PORT6_ADDR A:0x679a2158
y.create.l HWIO_QPIC_QPIC_LCDC_FIFO_DATA_PORT7_ADDR A:0x679a215c
y.create.l HWIO_QPIC_QPIC_LCDC_FIFO_DATA_PORT8_ADDR A:0x679a2160
y.create.l HWIO_QPIC_QPIC_LCDC_FIFO_DATA_PORT9_ADDR A:0x679a2164
y.create.l HWIO_QPIC_QPIC_LCDC_FIFO_EOF_ADDR A:0x679a2180
y.create.l HWIO_QPIC_LCD_DEVICE_CMD0_ADDR A:0x679a3000
y.create.l HWIO_QPIC_LCD_DEVICE_CMD1_ADDR A:0x679a3004
y.create.l HWIO_QPIC_LCD_DEVICE_CMD2_ADDR A:0x679a3008
y.create.l HWIO_QPIC_LCD_DEVICE_CMD3_ADDR A:0x679a300c
y.create.l HWIO_QPIC_LCD_DEVICE_CMD4_ADDR A:0x679a3010
y.create.l HWIO_QPIC_LCD_DEVICE_CMD5_ADDR A:0x679a3014
y.create.l HWIO_QPIC_LCD_DEVICE_CMD6_ADDR A:0x679a3018
y.create.l HWIO_QPIC_LCD_DEVICE_CMD7_ADDR A:0x679a301c
y.create.l HWIO_QPIC_LCD_DEVICE_CMD8_ADDR A:0x679a3020
y.create.l HWIO_QPIC_LCD_DEVICE_CMD9_ADDR A:0x679a3024
y.create.l HWIO_QPIC_QPIC_VERSION_ADDR A:0x679a0100
y.create.l HWIO_QPIC_QPIC_CTRL_ADDR A:0x679a0104
y.create.l HWIO_QPIC_QPIC_HW_INFO_ADDR A:0x679a0108
y.create.l HWIO_QPIC_QPIC_REG_PERMISSION_ADDR A:0x679a010c
y.create.l HWIO_QPIC_QPIC_DEBUG_ADDR A:0x679a0110
y.create.l HWIO_QPIC_QPIC_HW_GENERICS_ADDR A:0x679a0114
y.create.l HWIO_QPIC_NAND_FLASH_CMD_ADDR A:0x679b0000
y.create.l HWIO_QPIC_NAND_ADDR0_ADDR A:0x679b0004
y.create.l HWIO_QPIC_NAND_ADDR1_ADDR A:0x679b0008
y.create.l HWIO_QPIC_NAND_FLASH_CHIP_SELECT_ADDR A:0x679b000c
y.create.l HWIO_QPIC_NANDC_EXEC_CMD_ADDR A:0x679b0010
y.create.l HWIO_QPIC_NAND_FLASH_STATUS_ADDR A:0x679b0014
y.create.l HWIO_QPIC_NANDC_BUFFER_STATUS_ADDR A:0x679b0018
y.create.l HWIO_QPIC_NAND_DEV0_CFG0_ADDR A:0x679b0020
y.create.l HWIO_QPIC_NAND_DEV1_CFG0_ADDR A:0x679b0030
y.create.l HWIO_QPIC_NAND_DEV0_CFG1_ADDR A:0x679b0024
y.create.l HWIO_QPIC_NAND_DEV1_CFG1_ADDR A:0x679b0034
y.create.l HWIO_QPIC_NAND_DEV0_ECC_CFG_ADDR A:0x679b0028
y.create.l HWIO_QPIC_NAND_DEV1_ECC_CFG_ADDR A:0x679b002c
y.create.l HWIO_QPIC_NAND_FLASH_READ_ID_ADDR A:0x679b0040
y.create.l HWIO_QPIC_NAND_FLASH_READ_ID2_ADDR A:0x679b0048
y.create.l HWIO_QPIC_NAND_FLASH_READ_STATUS_ADDR A:0x679b0044
y.create.l HWIO_QPIC_NAND_FLASH_CONFIG_DATA_ADDR A:0x679b0050
y.create.l HWIO_QPIC_NAND_FLASH_CONFIG_ADDR A:0x679b0054
y.create.l HWIO_QPIC_NAND_FLASH_CONFIG_MODE_ADDR A:0x679b0058
y.create.l HWIO_QPIC_NAND_FLASH_CONFIG_STATUS_ADDR A:0x679b0060
y.create.l HWIO_QPIC_FLASH_MACRO1_REG_ADDR A:0x679b0064
y.create.l HWIO_QPIC_HSDDR_NAND_CFG_ADDR A:0x679b0068
y.create.l HWIO_QPIC_FLASH_XFR_STEP1_ADDR A:0x679b0070
y.create.l HWIO_QPIC_FLASH_XFR_STEP2_ADDR A:0x679b0074
y.create.l HWIO_QPIC_FLASH_XFR_STEP3_ADDR A:0x679b0078
y.create.l HWIO_QPIC_FLASH_XFR_STEP4_ADDR A:0x679b007c
y.create.l HWIO_QPIC_FLASH_XFR_STEP5_ADDR A:0x679b0080
y.create.l HWIO_QPIC_FLASH_XFR_STEP6_ADDR A:0x679b0084
y.create.l HWIO_QPIC_FLASH_XFR_STEP7_ADDR A:0x679b0088
y.create.l HWIO_QPIC_NAND_GENP_REG0_ADDR A:0x679b0090
y.create.l HWIO_QPIC_NAND_GENP_REG1_ADDR A:0x679b0094
y.create.l HWIO_QPIC_NAND_GENP_REG2_ADDR A:0x679b0098
y.create.l HWIO_QPIC_NAND_GENP_REG3_ADDR A:0x679b009c
y.create.l HWIO_QPIC_FLASH_DEV_CMD0_ADDR A:0x679b00a0
y.create.l HWIO_QPIC_FLASH_DEV_CMD1_ADDR A:0x679b00a4
y.create.l HWIO_QPIC_FLASH_DEV_CMD2_ADDR A:0x679b00a8
y.create.l HWIO_QPIC_FLASH_DEV_CMD_VLD_ADDR A:0x679b00ac
y.create.l HWIO_QPIC_NAND_ADDR2_ADDR A:0x679b00c0
y.create.l HWIO_QPIC_NAND_ADDR3_ADDR A:0x679b00c4
y.create.l HWIO_QPIC_NAND_ADDR4_ADDR A:0x679b00c8
y.create.l HWIO_QPIC_NAND_ADDR5_ADDR A:0x679b00cc
y.create.l HWIO_QPIC_FLASH_DEV_CMD3_ADDR A:0x679b00d0
y.create.l HWIO_QPIC_FLASH_DEV_CMD4_ADDR A:0x679b00d4
y.create.l HWIO_QPIC_FLASH_DEV_CMD5_ADDR A:0x679b00d8
y.create.l HWIO_QPIC_FLASH_DEV_CMD6_ADDR A:0x679b00dc
y.create.l HWIO_QPIC_NAND_ADDR6_ADDR A:0x679b00e4
y.create.l HWIO_QPIC_NAND_ERASED_CW_DETECT_CFG_ADDR A:0x679b00e8
y.create.l HWIO_QPIC_NAND_ERASED_CW_DETECT_STATUS_ADDR A:0x679b00ec
y.create.l HWIO_QPIC_EBI2_ECC_BUF_CFG_ADDR A:0x679b00f0
y.create.l HWIO_QPIC_NANDC_DBG_CFG_ADDR A:0x679b00f4
y.create.l HWIO_QPIC_NANDC_HW_PROFILE_CFG_ADDR A:0x679b00f8
y.create.l HWIO_QPIC_FLASH_BUFF0_ACC_ADDR A:0x679b0100
y.create.l HWIO_QPIC_FLASH_BUFF1_ACC_ADDR A:0x679b0104
y.create.l HWIO_QPIC_FLASH_BUFF2_ACC_ADDR A:0x679b0108
y.create.l HWIO_QPIC_FLASH_BUFF3_ACC_ADDR A:0x679b010c
y.create.l HWIO_QPIC_FLASH_BUFF4_ACC_ADDR A:0x679b0110
y.create.l HWIO_QPIC_FLASH_BUFF5_ACC_ADDR A:0x679b0114
y.create.l HWIO_QPIC_FLASH_BUFF6_ACC_ADDR A:0x679b0118
y.create.l HWIO_QPIC_FLASH_BUFF7_ACC_ADDR A:0x679b011c
y.create.l HWIO_QPIC_FLASH_BUFF8_ACC_ADDR A:0x679b0120
y.create.l HWIO_QPIC_FLASH_BUFF9_ACC_ADDR A:0x679b0124
y.create.l HWIO_QPIC_NAND_CTRL_ADDR A:0x679b0f00
y.create.l HWIO_QPIC_NAND_STATUS_ADDR A:0x679b0f04
y.create.l HWIO_QPIC_NAND_VERSION_ADDR A:0x679b0f08
y.create.l HWIO_QPIC_NAND_MPU_BYPASS_ADDR A:0x679b0f44
y.create.l HWIO_QPIC_NAND_DEBUG_ADDR A:0x679b0f0c
y.create.l HWIO_QPIC_NAND_IRQ_STTS_ADDR A:0x679b0f10
y.create.l HWIO_QPIC_NAND_IRQ_CLR_ADDR A:0x679b0f14
y.create.l HWIO_QPIC_NAND_IRQ_EN_ADDR A:0x679b0f18
y.create.l HWIO_QPIC_NAND_MUTEX_ADDR A:0x679b0f1c
y.create.l HWIO_QPIC_NAND_CONFIG_BITS_ADDR A:0x679b0f40
y.create.l HWIO_QPIC_NAND_READ_LOCATION_0_ADDR A:0x679b0f20
y.create.l HWIO_QPIC_NAND_READ_LOCATION_1_ADDR A:0x679b0f24
y.create.l HWIO_QPIC_NAND_READ_LOCATION_2_ADDR A:0x679b0f28
y.create.l HWIO_QPIC_NAND_READ_LOCATION_3_ADDR A:0x679b0f2c
y.create.l HWIO_QPIC_NAND_READ_LOCATION_4_ADDR A:0x679b0f30
y.create.l HWIO_QPIC_NAND_TEST_BUS_LSB_ADDR A:0x679b0f48
y.create.l HWIO_QPIC_NAND_TEST_BUS_MSB_ADDR A:0x679b0f4c
y.create.l HWIO_QPIC_NAND_OP_DONE_CNT_ADDR A:0x679b0f50
y.create.l HWIO_QPIC_NAND_ERR_RESP_TIME_OUT_ADDR A:0x679b0f54
y.create.l HWIO_QPIC_QPIC_MPU_XPU_SCR_ADDR A:0x679b1000
y.create.l HWIO_QPIC_QPIC_MPU_XPU_SWDR_ADDR A:0x679b1004
y.create.l HWIO_QPIC_QPIC_MPU_XPU_PRTN_RACR_SSHADOW_ADDR A:0x679b1008
y.create.l HWIO_QPIC_QPIC_MPU_XPU_PRTN_WACR_SSHADOW_ADDR A:0x679b100c
y.create.l HWIO_QPIC_QPIC_MPU_XPU_PRTN_START_SSHADOW0_ADDR A:0x679b1010
y.create.l HWIO_QPIC_QPIC_MPU_XPU_PRTN_START_SSHADOW1_ADDR A:0x679b1014
y.create.l HWIO_QPIC_QPIC_MPU_XPU_PRTN_END_SSHADOW0_ADDR A:0x679b1018
y.create.l HWIO_QPIC_QPIC_MPU_XPU_PRTN_END_SSHADOW1_ADDR A:0x679b101c
y.create.l HWIO_QPIC_QPIC_MPU_XPU_SEAR0_ADDR A:0x679b1040
y.create.l HWIO_QPIC_QPIC_MPU_XPU_SEAR1_ADDR A:0x679b1044
y.create.l HWIO_QPIC_QPIC_MPU_XPU_SESR_ADDR A:0x679b1048
y.create.l HWIO_QPIC_QPIC_MPU_XPU_SESRRESTORE_ADDR A:0x679b104c
y.create.l HWIO_QPIC_QPIC_MPU_XPU_SESYNR0_ADDR A:0x679b1050
y.create.l HWIO_QPIC_QPIC_MPU_XPU_SESYNR1_ADDR A:0x679b1054
y.create.l HWIO_QPIC_QPIC_MPU_XPU_SESYNR2_ADDR A:0x679b1058
y.create.l HWIO_QPIC_QPIC_MPU_XPU_MCR_ADDR A:0x679b1100
y.create.l HWIO_QPIC_QPIC_MPU_XPU_MEAR0_ADDR A:0x679b1140
y.create.l HWIO_QPIC_QPIC_MPU_XPU_MEAR1_ADDR A:0x679b1144
y.create.l HWIO_QPIC_QPIC_MPU_XPU_MESR_ADDR A:0x679b1148
y.create.l HWIO_QPIC_QPIC_MPU_XPU_MESRRESTORE_ADDR A:0x679b114c
y.create.l HWIO_QPIC_QPIC_MPU_XPU_MESYNR0_ADDR A:0x679b1150
y.create.l HWIO_QPIC_QPIC_MPU_XPU_MESYNR1_ADDR A:0x679b1154
y.create.l HWIO_QPIC_QPIC_MPU_XPU_MESYNR2_ADDR A:0x679b1158
y.create.l HWIO_QPIC_QPIC_MPU_XPU_CR_ADDR A:0x679b1080
y.create.l HWIO_QPIC_QPIC_MPU_XPU_PRTN_RACR_SHADOW_ADDR A:0x679b1088
y.create.l HWIO_QPIC_QPIC_MPU_XPU_PRTN_WACR_SHADOW_ADDR A:0x679b108c
y.create.l HWIO_QPIC_QPIC_MPU_XPU_PRTN_START_SHADOW0_ADDR A:0x679b1090
y.create.l HWIO_QPIC_QPIC_MPU_XPU_PRTN_START_SHADOW1_ADDR A:0x679b1094
y.create.l HWIO_QPIC_QPIC_MPU_XPU_PRTN_END_SHADOW0_ADDR A:0x679b1098
y.create.l HWIO_QPIC_QPIC_MPU_XPU_PRTN_END_SHADOW1_ADDR A:0x679b109c
y.create.l HWIO_QPIC_QPIC_MPU_XPU_RPU_ACR0_ADDR A:0x679b10a0
y.create.l HWIO_QPIC_QPIC_MPU_XPU_EAR0_ADDR A:0x679b10c0
y.create.l HWIO_QPIC_QPIC_MPU_XPU_EAR1_ADDR A:0x679b10c4
y.create.l HWIO_QPIC_QPIC_MPU_XPU_ESR_ADDR A:0x679b10c8
y.create.l HWIO_QPIC_QPIC_MPU_XPU_ESRRESTORE_ADDR A:0x679b10cc
y.create.l HWIO_QPIC_QPIC_MPU_XPU_ESYNR0_ADDR A:0x679b10d0
y.create.l HWIO_QPIC_QPIC_MPU_XPU_ESYNR1_ADDR A:0x679b10d4
y.create.l HWIO_QPIC_QPIC_MPU_XPU_ESYNR2_ADDR A:0x679b10d8
y.create.l HWIO_QPIC_QPIC_MPU_XPU_UMR_RACR_ADDR A:0x679b10e0
y.create.l HWIO_QPIC_QPIC_MPU_XPU_UMR_WACR_ADDR A:0x679b10e4
y.create.l HWIO_QPIC_QPIC_MPU_XPU_UMR_CNTL_ADDR A:0x679b10f0
y.create.l HWIO_QPIC_QPIC_MPU_XPU_IDR0_ADDR A:0x679b1074
y.create.l HWIO_QPIC_QPIC_MPU_XPU_IDR1_ADDR A:0x679b1078
y.create.l HWIO_QPIC_QPIC_MPU_XPU_REV_ADDR A:0x679b107c
y.create.l HWIO_QPIC_QPIC_MPU_XPU_PRT0_RACR0_ADDR A:0x679b1200
y.create.l HWIO_QPIC_QPIC_MPU_XPU_PRT1_RACR0_ADDR A:0x679b1280
y.create.l HWIO_QPIC_QPIC_MPU_XPU_PRT2_RACR0_ADDR A:0x679b1300
y.create.l HWIO_QPIC_QPIC_MPU_XPU_PRT3_RACR0_ADDR A:0x679b1380
y.create.l HWIO_QPIC_QPIC_MPU_XPU_PRT4_RACR0_ADDR A:0x679b1400
y.create.l HWIO_QPIC_QPIC_MPU_XPU_PRT5_RACR0_ADDR A:0x679b1480
y.create.l HWIO_QPIC_QPIC_MPU_XPU_PRT6_RACR0_ADDR A:0x679b1500
y.create.l HWIO_QPIC_QPIC_MPU_XPU_PRT7_RACR0_ADDR A:0x679b1580
y.create.l HWIO_QPIC_QPIC_MPU_XPU_PRT0_WACR0_ADDR A:0x679b1220
y.create.l HWIO_QPIC_QPIC_MPU_XPU_PRT1_WACR0_ADDR A:0x679b12a0
y.create.l HWIO_QPIC_QPIC_MPU_XPU_PRT2_WACR0_ADDR A:0x679b1320
y.create.l HWIO_QPIC_QPIC_MPU_XPU_PRT3_WACR0_ADDR A:0x679b13a0
y.create.l HWIO_QPIC_QPIC_MPU_XPU_PRT4_WACR0_ADDR A:0x679b1420
y.create.l HWIO_QPIC_QPIC_MPU_XPU_PRT5_WACR0_ADDR A:0x679b14a0
y.create.l HWIO_QPIC_QPIC_MPU_XPU_PRT6_WACR0_ADDR A:0x679b1520
y.create.l HWIO_QPIC_QPIC_MPU_XPU_PRT7_WACR0_ADDR A:0x679b15a0
y.create.l HWIO_QPIC_QPIC_MPU_XPU_PRT0_START0_ADDR A:0x679b1240
y.create.l HWIO_QPIC_QPIC_MPU_XPU_PRT1_START0_ADDR A:0x679b12c0
y.create.l HWIO_QPIC_QPIC_MPU_XPU_PRT2_START0_ADDR A:0x679b1340
y.create.l HWIO_QPIC_QPIC_MPU_XPU_PRT3_START0_ADDR A:0x679b13c0
y.create.l HWIO_QPIC_QPIC_MPU_XPU_PRT4_START0_ADDR A:0x679b1440
y.create.l HWIO_QPIC_QPIC_MPU_XPU_PRT5_START0_ADDR A:0x679b14c0
y.create.l HWIO_QPIC_QPIC_MPU_XPU_PRT6_START0_ADDR A:0x679b1540
y.create.l HWIO_QPIC_QPIC_MPU_XPU_PRT7_START0_ADDR A:0x679b15c0
y.create.l HWIO_QPIC_QPIC_MPU_XPU_PRT0_START1_ADDR A:0x679b1244
y.create.l HWIO_QPIC_QPIC_MPU_XPU_PRT1_START1_ADDR A:0x679b12c4
y.create.l HWIO_QPIC_QPIC_MPU_XPU_PRT2_START1_ADDR A:0x679b1344
y.create.l HWIO_QPIC_QPIC_MPU_XPU_PRT3_START1_ADDR A:0x679b13c4
y.create.l HWIO_QPIC_QPIC_MPU_XPU_PRT4_START1_ADDR A:0x679b1444
y.create.l HWIO_QPIC_QPIC_MPU_XPU_PRT5_START1_ADDR A:0x679b14c4
y.create.l HWIO_QPIC_QPIC_MPU_XPU_PRT6_START1_ADDR A:0x679b1544
y.create.l HWIO_QPIC_QPIC_MPU_XPU_PRT7_START1_ADDR A:0x679b15c4
y.create.l HWIO_QPIC_QPIC_MPU_XPU_PRT0_END0_ADDR A:0x679b1248
y.create.l HWIO_QPIC_QPIC_MPU_XPU_PRT1_END0_ADDR A:0x679b12c8
y.create.l HWIO_QPIC_QPIC_MPU_XPU_PRT2_END0_ADDR A:0x679b1348
y.create.l HWIO_QPIC_QPIC_MPU_XPU_PRT3_END0_ADDR A:0x679b13c8
y.create.l HWIO_QPIC_QPIC_MPU_XPU_PRT4_END0_ADDR A:0x679b1448
y.create.l HWIO_QPIC_QPIC_MPU_XPU_PRT5_END0_ADDR A:0x679b14c8
y.create.l HWIO_QPIC_QPIC_MPU_XPU_PRT6_END0_ADDR A:0x679b1548
y.create.l HWIO_QPIC_QPIC_MPU_XPU_PRT7_END0_ADDR A:0x679b15c8
y.create.l HWIO_QPIC_QPIC_MPU_XPU_PRT0_END1_ADDR A:0x679b124c
y.create.l HWIO_QPIC_QPIC_MPU_XPU_PRT1_END1_ADDR A:0x679b12cc
y.create.l HWIO_QPIC_QPIC_MPU_XPU_PRT2_END1_ADDR A:0x679b134c
y.create.l HWIO_QPIC_QPIC_MPU_XPU_PRT3_END1_ADDR A:0x679b13cc
y.create.l HWIO_QPIC_QPIC_MPU_XPU_PRT4_END1_ADDR A:0x679b144c
y.create.l HWIO_QPIC_QPIC_MPU_XPU_PRT5_END1_ADDR A:0x679b14cc
y.create.l HWIO_QPIC_QPIC_MPU_XPU_PRT6_END1_ADDR A:0x679b154c
y.create.l HWIO_QPIC_QPIC_MPU_XPU_PRT7_END1_ADDR A:0x679b15cc
y.create.l HWIO_QPIC_QPIC_MPU_XPU_PRT0_SCR_ADDR A:0x679b1250
y.create.l HWIO_QPIC_QPIC_MPU_XPU_PRT1_SCR_ADDR A:0x679b12d0
y.create.l HWIO_QPIC_QPIC_MPU_XPU_PRT2_SCR_ADDR A:0x679b1350
y.create.l HWIO_QPIC_QPIC_MPU_XPU_PRT3_SCR_ADDR A:0x679b13d0
y.create.l HWIO_QPIC_QPIC_MPU_XPU_PRT4_SCR_ADDR A:0x679b1450
y.create.l HWIO_QPIC_QPIC_MPU_XPU_PRT5_SCR_ADDR A:0x679b14d0
y.create.l HWIO_QPIC_QPIC_MPU_XPU_PRT6_SCR_ADDR A:0x679b1550
y.create.l HWIO_QPIC_QPIC_MPU_XPU_PRT7_SCR_ADDR A:0x679b15d0
y.create.l HWIO_QPIC_QPIC_MPU_XPU_PRT0_MCR_ADDR A:0x679b1254
y.create.l HWIO_QPIC_QPIC_MPU_XPU_PRT1_MCR_ADDR A:0x679b12d4
y.create.l HWIO_QPIC_QPIC_MPU_XPU_PRT2_MCR_ADDR A:0x679b1354
y.create.l HWIO_QPIC_QPIC_MPU_XPU_PRT3_MCR_ADDR A:0x679b13d4
y.create.l HWIO_QPIC_QPIC_MPU_XPU_PRT4_MCR_ADDR A:0x679b1454
y.create.l HWIO_QPIC_QPIC_MPU_XPU_PRT5_MCR_ADDR A:0x679b14d4
y.create.l HWIO_QPIC_QPIC_MPU_XPU_PRT6_MCR_ADDR A:0x679b1554
y.create.l HWIO_QPIC_QPIC_MPU_XPU_PRT7_MCR_ADDR A:0x679b15d4
y.create.l HWIO_QPIC_QPIC_MPU_XPU_PRT0_CNTL0_ADDR A:0x679b1258
y.create.l HWIO_QPIC_QPIC_MPU_XPU_PRT1_CNTL0_ADDR A:0x679b12d8
y.create.l HWIO_QPIC_QPIC_MPU_XPU_PRT2_CNTL0_ADDR A:0x679b1358
y.create.l HWIO_QPIC_QPIC_MPU_XPU_PRT3_CNTL0_ADDR A:0x679b13d8
y.create.l HWIO_QPIC_QPIC_MPU_XPU_PRT4_CNTL0_ADDR A:0x679b1458
y.create.l HWIO_QPIC_QPIC_MPU_XPU_PRT5_CNTL0_ADDR A:0x679b14d8
y.create.l HWIO_QPIC_QPIC_MPU_XPU_PRT6_CNTL0_ADDR A:0x679b1558
y.create.l HWIO_QPIC_QPIC_MPU_XPU_PRT7_CNTL0_ADDR A:0x679b15d8
y.create.l HWIO_QPIC_QPIC_MPU_XPU_PRT0_CNTL1_ADDR A:0x679b125c
y.create.l HWIO_QPIC_QPIC_MPU_XPU_PRT1_CNTL1_ADDR A:0x679b12dc
y.create.l HWIO_QPIC_QPIC_MPU_XPU_PRT2_CNTL1_ADDR A:0x679b135c
y.create.l HWIO_QPIC_QPIC_MPU_XPU_PRT3_CNTL1_ADDR A:0x679b13dc
y.create.l HWIO_QPIC_QPIC_MPU_XPU_PRT4_CNTL1_ADDR A:0x679b145c
y.create.l HWIO_QPIC_QPIC_MPU_XPU_PRT5_CNTL1_ADDR A:0x679b14dc
y.create.l HWIO_QPIC_QPIC_MPU_XPU_PRT6_CNTL1_ADDR A:0x679b155c
y.create.l HWIO_QPIC_QPIC_MPU_XPU_PRT7_CNTL1_ADDR A:0x679b15dc
y.create.l HWIO_RBCPR_VERSION_ADDR A:0x60048000
y.create.l HWIO_RBCPR_SENSOR_MASK0_ADDR A:0x60048020
y.create.l HWIO_RBCPR_SENSOR_MASK1_ADDR A:0x60048024
y.create.l HWIO_RBCPR_SENSOR_MASK2_ADDR A:0x60048028
y.create.l HWIO_RBCPR_SENSOR_MASK3_ADDR A:0x6004802c
y.create.l HWIO_RBCPR_SENSOR_BYPASS0_ADDR A:0x60048030
y.create.l HWIO_RBCPR_SENSOR_BYPASS1_ADDR A:0x60048034
y.create.l HWIO_RBCPR_SENSOR_BYPASS2_ADDR A:0x60048038
y.create.l HWIO_RBCPR_SENSOR_BYPASS3_ADDR A:0x6004803c
y.create.l HWIO_RBIF_PMIC_ADDR_ADDR A:0x60048040
y.create.l HWIO_RBCPR_TIMER_INTERVAL_ADDR A:0x60048044
y.create.l HWIO_RBIF_LIMIT_ADDR A:0x60048048
y.create.l HWIO_RBIF_TIMER_ADJUST_ADDR A:0x6004804c
y.create.l HWIO_RBCPR_GCNT_TARGET0_ADDR A:0x60048060
y.create.l HWIO_RBCPR_GCNT_TARGET1_ADDR A:0x60048064
y.create.l HWIO_RBCPR_GCNT_TARGET2_ADDR A:0x60048068
y.create.l HWIO_RBCPR_GCNT_TARGET3_ADDR A:0x6004806c
y.create.l HWIO_RBCPR_GCNT_TARGET4_ADDR A:0x60048070
y.create.l HWIO_RBCPR_GCNT_TARGET5_ADDR A:0x60048074
y.create.l HWIO_RBCPR_GCNT_TARGET6_ADDR A:0x60048078
y.create.l HWIO_RBCPR_GCNT_TARGET7_ADDR A:0x6004807c
y.create.l HWIO_RBCPR_STEP_QUOT_ADDR A:0x60048080
y.create.l HWIO_RBCPR_CTL_ADDR A:0x60048090
y.create.l HWIO_RBIF_SW_VLEVEL_ADDR A:0x60048094
y.create.l HWIO_RBIF_CONT_ACK_CMD_ADDR A:0x60048098
y.create.l HWIO_RBIF_CONT_NACK_CMD_ADDR A:0x6004809c
y.create.l HWIO_RBCPR_RESULT_0_ADDR A:0x600480a0
y.create.l HWIO_RBCPR_RESULT_1_ADDR A:0x600480a4
y.create.l HWIO_RBIF_IRQ_EN_0_ADDR A:0x60048100
y.create.l HWIO_RBIF_IRQ_EN_1_ADDR A:0x60048104
y.create.l HWIO_RBIF_IRQ_EN_2_ADDR A:0x60048108
y.create.l HWIO_RBIF_IRQ_CLEAR_ADDR A:0x60048110
y.create.l HWIO_RBIF_IRQ_STATUS_ADDR A:0x60048114
y.create.l HWIO_RBCPR_QUOT_AVG_ADDR A:0x60048118
y.create.l HWIO_RBCPR_DEBUG0_ADDR A:0x6004811c
y.create.l HWIO_RBCPR_DEBUG1_ADDR A:0x60048120
y.create.l HWIO_RBCPR_DEBUG2_ADDR A:0x60048124
y.create.l HWIO_RBCPR_BIST_MINMAX_ADDR A:0x60048128
y.create.l HWIO_RBCPR_BIST_RESULT_ADDR A:0x6004812c
y.create.l HWIO_RBCPR_BIST_FAIL_MAP0_ADDR A:0x60048130
y.create.l HWIO_RBCPR_BIST_FAIL_MAP1_ADDR A:0x60048134
y.create.l HWIO_RBCPR_BIST_FAIL_MAP2_ADDR A:0x60048138
y.create.l HWIO_RBCPR_BIST_FAIL_MAP3_ADDR A:0x6004813c
y.create.l HWIO_RBCPR_LOG_0_ADDR A:0x60048140
y.create.l HWIO_RBCPR_LOG_1_ADDR A:0x60048144
y.create.l HWIO_RBCPR_LOG_2_ADDR A:0x60048148
y.create.l HWIO_RBCPR_LOG_3_ADDR A:0x6004814c
y.create.l HWIO_RBCPR_LOG_4_ADDR A:0x60048150
y.create.l HWIO_RBCPR_LOG_5_ADDR A:0x60048154
y.create.l HWIO_RBCPR_LOG_6_ADDR A:0x60048158
y.create.l HWIO_RBCPR_LOG_7_ADDR A:0x6004815c
y.create.l HWIO_RBCPR_HTOL_AGE_ADDR A:0x60048160
y.create.l HWIO_RPM_HW_VERSION_ADDR A:0x80000
y.create.l HWIO_RPM_WFI_CONFIG_ADDR A:0x80004
y.create.l HWIO_RPM_TIMERS_CLK_OFF_CTL_ADDR A:0x80008
y.create.l HWIO_RPM_IPC_ADDR A:0x8000c
y.create.l HWIO_RPM_GPO_WDATA_ADDR A:0x80010
y.create.l HWIO_RPM_GPO_WDSET_ADDR A:0x80014
y.create.l HWIO_RPM_GPO_WDCLR_ADDR A:0x80018
y.create.l HWIO_RPM_SLAVES_CLK_GATING_ADDR A:0x8001c
y.create.l HWIO_RPM_INTR_POLARITY_0_ADDR A:0x80030
y.create.l HWIO_RPM_INTR_POLARITY_1_ADDR A:0x80034
y.create.l HWIO_RPM_INTR_EDG_LVL_0_ADDR A:0x80038
y.create.l HWIO_RPM_INTR_EDG_LVL_1_ADDR A:0x8003c
y.create.l HWIO_RPM_WDOG_RESET_ADDR A:0x80040
y.create.l HWIO_RPM_WDOG_CTRL_ADDR A:0x80044
y.create.l HWIO_RPM_WDOG_STATUS_ADDR A:0x80048
y.create.l HWIO_RPM_WDOG_BARK_TIME_ADDR A:0x8004c
y.create.l HWIO_RPM_WDOG_BITE_TIME_ADDR A:0x80050
y.create.l HWIO_RPM_WDOG_TEST_LOAD_ADDR A:0x80054
y.create.l HWIO_RPM_WDOG_TEST_ADDR A:0x80058
y.create.l HWIO_RPM_TEST_BUS_SEL_ADDR A:0x8005c
y.create.l HWIO_RPM_SPARE_REG0_ADDR A:0x80060
y.create.l HWIO_RPM_SPARE_REG1_ADDR A:0x80064
y.create.l HWIO_RPM_SPARE_REG2_ADDR A:0x80068
y.create.l HWIO_RPM_SPARE_REG3_ADDR A:0x8006c
y.create.l HWIO_RPM_PAGE_SELECT_ADDR A:0x80070
y.create.l HWIO_RPM_QTMR_AC_CNTFRQ_ADDR A:0x82000
y.create.l HWIO_RPM_QTMR_AC_CNTSR_ADDR A:0x82004
y.create.l HWIO_RPM_QTMR_AC_CNTTID_ADDR A:0x82008
y.create.l HWIO_RPM_QTMR_AC_CNTACR_0_ADDR A:0x82040
y.create.l HWIO_RPM_QTMR_AC_CNTACR_1_ADDR A:0x82044
y.create.l HWIO_RPM_QTMR_AC_CNTVOFF_LO_0_ADDR A:0x82080
y.create.l HWIO_RPM_QTMR_AC_CNTVOFF_LO_1_ADDR A:0x82088
y.create.l HWIO_RPM_QTMR_AC_CNTVOFF_HI_0_ADDR A:0x82084
y.create.l HWIO_RPM_QTMR_AC_CNTVOFF_HI_1_ADDR A:0x8208c
y.create.l HWIO_RPM_QTMR_AC_CFG_ADDR A:0x82fc0
y.create.l HWIO_RPM_QTMR_AC_VERSION_ADDR A:0x82fd0
y.create.l HWIO_RPM_F0_QTMR_V1_CNTPCT_LO_ADDR A:0x83000
y.create.l HWIO_RPM_F0_QTMR_V1_CNTPCT_HI_ADDR A:0x83004
y.create.l HWIO_RPM_F0_QTMR_V1_CNTVCT_LO_ADDR A:0x83008
y.create.l HWIO_RPM_F0_QTMR_V1_CNTVCT_HI_ADDR A:0x8300c
y.create.l HWIO_RPM_F0_QTMR_V1_CNTFRQ_ADDR A:0x83010
y.create.l HWIO_RPM_F0_QTMR_V1_CNTPL0ACR_ADDR A:0x83014
y.create.l HWIO_RPM_F0_QTMR_V1_CNTVOFF_LO_ADDR A:0x83018
y.create.l HWIO_RPM_F0_QTMR_V1_CNTVOFF_HI_ADDR A:0x8301c
y.create.l HWIO_RPM_F0_QTMR_V1_CNTP_CVAL_LO_ADDR A:0x83020
y.create.l HWIO_RPM_F0_QTMR_V1_CNTP_CVAL_HI_ADDR A:0x83024
y.create.l HWIO_RPM_F0_QTMR_V1_CNTP_TVAL_ADDR A:0x83028
y.create.l HWIO_RPM_F0_QTMR_V1_CNTP_CTL_ADDR A:0x8302c
y.create.l HWIO_RPM_F0_QTMR_V1_CNTV_CVAL_LO_ADDR A:0x83030
y.create.l HWIO_RPM_F0_QTMR_V1_CNTV_CVAL_HI_ADDR A:0x83034
y.create.l HWIO_RPM_F0_QTMR_V1_CNTV_TVAL_ADDR A:0x83038
y.create.l HWIO_RPM_F0_QTMR_V1_CNTV_CTL_ADDR A:0x8303c
y.create.l HWIO_RPM_F0_QTMR_V1_VERSION_ADDR A:0x83fd0
y.create.l HWIO_RPM_F1_QTMR_V1_CNTPCT_LO_ADDR A:0x84000
y.create.l HWIO_RPM_F1_QTMR_V1_CNTPCT_HI_ADDR A:0x84004
y.create.l HWIO_RPM_F1_QTMR_V1_CNTVCT_LO_ADDR A:0x84008
y.create.l HWIO_RPM_F1_QTMR_V1_CNTVCT_HI_ADDR A:0x8400c
y.create.l HWIO_RPM_F1_QTMR_V1_CNTFRQ_ADDR A:0x84010
y.create.l HWIO_RPM_F1_QTMR_V1_CNTPL0ACR_ADDR A:0x84014
y.create.l HWIO_RPM_F1_QTMR_V1_CNTVOFF_LO_ADDR A:0x84018
y.create.l HWIO_RPM_F1_QTMR_V1_CNTVOFF_HI_ADDR A:0x8401c
y.create.l HWIO_RPM_F1_QTMR_V1_CNTP_CVAL_LO_ADDR A:0x84020
y.create.l HWIO_RPM_F1_QTMR_V1_CNTP_CVAL_HI_ADDR A:0x84024
y.create.l HWIO_RPM_F1_QTMR_V1_CNTP_TVAL_ADDR A:0x84028
y.create.l HWIO_RPM_F1_QTMR_V1_CNTP_CTL_ADDR A:0x8402c
y.create.l HWIO_RPM_F1_QTMR_V1_CNTV_CVAL_LO_ADDR A:0x84030
y.create.l HWIO_RPM_F1_QTMR_V1_CNTV_CVAL_HI_ADDR A:0x84034
y.create.l HWIO_RPM_F1_QTMR_V1_CNTV_TVAL_ADDR A:0x84038
y.create.l HWIO_RPM_F1_QTMR_V1_CNTV_CTL_ADDR A:0x8403c
y.create.l HWIO_RPM_F1_QTMR_V1_VERSION_ADDR A:0x84fd0
y.create.l HWIO_RPM_APU_XPU_SCR_ADDR A:0x87000
y.create.l HWIO_RPM_APU_XPU_SWDR_ADDR A:0x87004
y.create.l HWIO_RPM_APU_XPU_SEAR0_ADDR A:0x87040
y.create.l HWIO_RPM_APU_XPU_SESR_ADDR A:0x87048
y.create.l HWIO_RPM_APU_XPU_SESRRESTORE_ADDR A:0x8704c
y.create.l HWIO_RPM_APU_XPU_SESYNR0_ADDR A:0x87050
y.create.l HWIO_RPM_APU_XPU_SESYNR1_ADDR A:0x87054
y.create.l HWIO_RPM_APU_XPU_SESYNR2_ADDR A:0x87058
y.create.l HWIO_RPM_APU_XPU_MCR_ADDR A:0x87100
y.create.l HWIO_RPM_APU_XPU_MEAR0_ADDR A:0x87140
y.create.l HWIO_RPM_APU_XPU_MESR_ADDR A:0x87148
y.create.l HWIO_RPM_APU_XPU_MESRRESTORE_ADDR A:0x8714c
y.create.l HWIO_RPM_APU_XPU_MESYNR0_ADDR A:0x87150
y.create.l HWIO_RPM_APU_XPU_MESYNR1_ADDR A:0x87154
y.create.l HWIO_RPM_APU_XPU_MESYNR2_ADDR A:0x87158
y.create.l HWIO_RPM_APU_XPU_CR_ADDR A:0x87080
y.create.l HWIO_RPM_APU_XPU_RPU_ACR0_ADDR A:0x870a0
y.create.l HWIO_RPM_APU_XPU_EAR0_ADDR A:0x870c0
y.create.l HWIO_RPM_APU_XPU_ESR_ADDR A:0x870c8
y.create.l HWIO_RPM_APU_XPU_ESRRESTORE_ADDR A:0x870cc
y.create.l HWIO_RPM_APU_XPU_ESYNR0_ADDR A:0x870d0
y.create.l HWIO_RPM_APU_XPU_ESYNR1_ADDR A:0x870d4
y.create.l HWIO_RPM_APU_XPU_ESYNR2_ADDR A:0x870d8
y.create.l HWIO_RPM_APU_XPU_IDR0_ADDR A:0x87074
y.create.l HWIO_RPM_APU_XPU_IDR1_ADDR A:0x87078
y.create.l HWIO_RPM_APU_XPU_REV_ADDR A:0x8707c
y.create.l HWIO_RPM_APU_XPU_RG0_RACR0_ADDR A:0x87200
y.create.l HWIO_RPM_APU_XPU_RG1_RACR0_ADDR A:0x87280
y.create.l HWIO_RPM_APU_XPU_RG0_WACR0_ADDR A:0x87220
y.create.l HWIO_RPM_APU_XPU_RG1_WACR0_ADDR A:0x872a0
y.create.l HWIO_RPM_APU_XPU_RG0_SCR_ADDR A:0x87250
y.create.l HWIO_RPM_APU_XPU_RG1_SCR_ADDR A:0x872d0
y.create.l HWIO_RPM_APU_XPU_RG0_MCR_ADDR A:0x87254
y.create.l HWIO_RPM_APU_XPU_RG1_MCR_ADDR A:0x872d4
y.create.l HWIO_RPM_VMIDMT_SCR0_ADDR A:0x88000
y.create.l HWIO_RPM_VMIDMT_SCR1_ADDR A:0x88004
y.create.l HWIO_RPM_VMIDMT_SCR2_ADDR A:0x88008
y.create.l HWIO_RPM_VMIDMT_SACR_ADDR A:0x88010
y.create.l HWIO_RPM_VMIDMT_SIDR0_ADDR A:0x88020
y.create.l HWIO_RPM_VMIDMT_SIDR1_ADDR A:0x88024
y.create.l HWIO_RPM_VMIDMT_SIDR2_ADDR A:0x88028
y.create.l HWIO_RPM_VMIDMT_SIDR4_ADDR A:0x88030
y.create.l HWIO_RPM_VMIDMT_SIDR5_ADDR A:0x88034
y.create.l HWIO_RPM_VMIDMT_SIDR7_ADDR A:0x8803c
y.create.l HWIO_RPM_VMIDMT_SGFAR0_ADDR A:0x88040
y.create.l HWIO_RPM_VMIDMT_SGFSR_ADDR A:0x88048
y.create.l HWIO_RPM_VMIDMT_SGFSRRESTORE_ADDR A:0x8804c
y.create.l HWIO_RPM_VMIDMT_SGFSYNDR0_ADDR A:0x88050
y.create.l HWIO_RPM_VMIDMT_SGFSYNDR1_ADDR A:0x88054
y.create.l HWIO_RPM_VMIDMT_SGFSYNDR2_ADDR A:0x88058
y.create.l HWIO_RPM_VMIDMT_VMIDMTSCR0_ADDR A:0x88090
y.create.l HWIO_RPM_VMIDMT_CR0_ADDR A:0x88000
y.create.l HWIO_RPM_VMIDMT_CR2_ADDR A:0x88008
y.create.l HWIO_RPM_VMIDMT_ACR_ADDR A:0x88010
y.create.l HWIO_RPM_VMIDMT_IDR0_ADDR A:0x88020
y.create.l HWIO_RPM_VMIDMT_IDR1_ADDR A:0x88024
y.create.l HWIO_RPM_VMIDMT_IDR2_ADDR A:0x88028
y.create.l HWIO_RPM_VMIDMT_IDR4_ADDR A:0x88030
y.create.l HWIO_RPM_VMIDMT_IDR5_ADDR A:0x88034
y.create.l HWIO_RPM_VMIDMT_IDR7_ADDR A:0x8803c
y.create.l HWIO_RPM_VMIDMT_GFAR0_ADDR A:0x88040
y.create.l HWIO_RPM_VMIDMT_GFSR_ADDR A:0x88048
y.create.l HWIO_RPM_VMIDMT_GFSRRESTORE_ADDR A:0x8804c
y.create.l HWIO_RPM_VMIDMT_GFSYNDR0_ADDR A:0x88050
y.create.l HWIO_RPM_VMIDMT_GFSYNDR1_ADDR A:0x88054
y.create.l HWIO_RPM_VMIDMT_GFSYNDR2_ADDR A:0x88058
y.create.l HWIO_RPM_VMIDMT_VMIDMTCR0_ADDR A:0x88090
y.create.l HWIO_RPM_VMIDMT_VMIDMTACR_ADDR A:0x8809c
y.create.l HWIO_RPM_VMIDMT_NSCR0_ADDR A:0x88400
y.create.l HWIO_RPM_VMIDMT_NSCR2_ADDR A:0x88408
y.create.l HWIO_RPM_VMIDMT_NSACR_ADDR A:0x88410
y.create.l HWIO_RPM_VMIDMT_NSGFAR0_ADDR A:0x88440
y.create.l HWIO_RPM_VMIDMT_NSGFSR_ADDR A:0x88448
y.create.l HWIO_RPM_VMIDMT_NSGFSRRESTORE_ADDR A:0x8844c
y.create.l HWIO_RPM_VMIDMT_NSGFSYNDR0_ADDR A:0x88450
y.create.l HWIO_RPM_VMIDMT_NSGFSYNDR1_ADDR A:0x88454
y.create.l HWIO_RPM_VMIDMT_NSGFSYNDR2_ADDR A:0x88458
y.create.l HWIO_RPM_VMIDMT_NSVMIDMTCR0_ADDR A:0x88490
y.create.l HWIO_RPM_VMIDMT_SSDR0_ADDR A:0x88080
y.create.l HWIO_RPM_VMIDMT_MSDR0_ADDR A:0x88480
y.create.l HWIO_RPM_VMIDMT_MCR_ADDR A:0x88494
y.create.l HWIO_RPM_VMIDMT_S2VR0_ADDR A:0x88c00
y.create.l HWIO_RPM_VMIDMT_AS2VR0_ADDR A:0x88e00
y.create.l HWIO_RPM_M3_ITM_ITM_STIM0_ADDR A:0xe0000000
y.create.l HWIO_RPM_M3_ITM_ITM_STIM1_ADDR A:0xe0000004
y.create.l HWIO_RPM_M3_ITM_ITM_STIM2_ADDR A:0xe0000008
y.create.l HWIO_RPM_M3_ITM_ITM_STIM3_ADDR A:0xe000000c
y.create.l HWIO_RPM_M3_ITM_ITM_STIM4_ADDR A:0xe0000010
y.create.l HWIO_RPM_M3_ITM_ITM_STIM5_ADDR A:0xe0000014
y.create.l HWIO_RPM_M3_ITM_ITM_STIM6_ADDR A:0xe0000018
y.create.l HWIO_RPM_M3_ITM_ITM_STIM7_ADDR A:0xe000001c
y.create.l HWIO_RPM_M3_ITM_ITM_STIM8_ADDR A:0xe0000020
y.create.l HWIO_RPM_M3_ITM_ITM_STIM9_ADDR A:0xe0000024
y.create.l HWIO_RPM_M3_ITM_ITM_STIM10_ADDR A:0xe0000028
y.create.l HWIO_RPM_M3_ITM_ITM_STIM11_ADDR A:0xe000002c
y.create.l HWIO_RPM_M3_ITM_ITM_STIM12_ADDR A:0xe0000030
y.create.l HWIO_RPM_M3_ITM_ITM_STIM13_ADDR A:0xe0000034
y.create.l HWIO_RPM_M3_ITM_ITM_STIM14_ADDR A:0xe0000038
y.create.l HWIO_RPM_M3_ITM_ITM_STIM15_ADDR A:0xe000003c
y.create.l HWIO_RPM_M3_ITM_ITM_STIM16_ADDR A:0xe0000040
y.create.l HWIO_RPM_M3_ITM_ITM_STIM17_ADDR A:0xe0000044
y.create.l HWIO_RPM_M3_ITM_ITM_STIM18_ADDR A:0xe0000048
y.create.l HWIO_RPM_M3_ITM_ITM_STIM19_ADDR A:0xe000004c
y.create.l HWIO_RPM_M3_ITM_ITM_STIM20_ADDR A:0xe0000050
y.create.l HWIO_RPM_M3_ITM_ITM_STIM21_ADDR A:0xe0000054
y.create.l HWIO_RPM_M3_ITM_ITM_STIM22_ADDR A:0xe0000058
y.create.l HWIO_RPM_M3_ITM_ITM_STIM23_ADDR A:0xe000005c
y.create.l HWIO_RPM_M3_ITM_ITM_STIM24_ADDR A:0xe0000060
y.create.l HWIO_RPM_M3_ITM_ITM_STIM25_ADDR A:0xe0000064
y.create.l HWIO_RPM_M3_ITM_ITM_STIM26_ADDR A:0xe0000068
y.create.l HWIO_RPM_M3_ITM_ITM_STIM27_ADDR A:0xe000006c
y.create.l HWIO_RPM_M3_ITM_ITM_STIM28_ADDR A:0xe0000070
y.create.l HWIO_RPM_M3_ITM_ITM_STIM29_ADDR A:0xe0000074
y.create.l HWIO_RPM_M3_ITM_ITM_STIM30_ADDR A:0xe0000078
y.create.l HWIO_RPM_M3_ITM_ITM_STIM31_ADDR A:0xe000007c
y.create.l HWIO_RPM_M3_ITM_ITM_TER_ADDR A:0xe0000e00
y.create.l HWIO_RPM_M3_ITM_ITM_TPR_ADDR A:0xe0000e40
y.create.l HWIO_RPM_M3_ITM_ITM_TCR_ADDR A:0xe0000e80
y.create.l HWIO_RPM_M3_ITM_ITM_IWR_ADDR A:0xe0000ef8
y.create.l HWIO_RPM_M3_ITM_ITM_IMCR_ADDR A:0xe0000f00
y.create.l HWIO_RPM_M3_ITM_ITM_LAR_ADDR A:0xe0000fb0
y.create.l HWIO_RPM_M3_ITM_ITM_LSR_ADDR A:0xe0000fb4
y.create.l HWIO_RPM_M3_ITM_PID4_ADDR A:0xe0000fd0
y.create.l HWIO_RPM_M3_ITM_PID5_ADDR A:0xe0000fd4
y.create.l HWIO_RPM_M3_ITM_PID6_ADDR A:0xe0000fd8
y.create.l HWIO_RPM_M3_ITM_PID7_ADDR A:0xe0000fdc
y.create.l HWIO_RPM_M3_ITM_PID0_ADDR A:0xe0000fe0
y.create.l HWIO_RPM_M3_ITM_PID1_ADDR A:0xe0000fe4
y.create.l HWIO_RPM_M3_ITM_PID2_ADDR A:0xe0000fe8
y.create.l HWIO_RPM_M3_ITM_PID3_ADDR A:0xe0000fec
y.create.l HWIO_RPM_M3_ITM_CID0_ADDR A:0xe0000ff0
y.create.l HWIO_RPM_M3_ITM_CID1_ADDR A:0xe0000ff4
y.create.l HWIO_RPM_M3_ITM_CID2_ADDR A:0xe0000ff8
y.create.l HWIO_RPM_M3_ITM_CID3_ADDR A:0xe0000ffc
y.create.l HWIO_RPM_M3_DWT_DWT_CTRL_ADDR A:0xe0001000
y.create.l HWIO_RPM_M3_DWT_DWT_CYCCNT_ADDR A:0xe0001004
y.create.l HWIO_RPM_M3_DWT_DWT_CPICNT_ADDR A:0xe0001008
y.create.l HWIO_RPM_M3_DWT_DWT_EXCCNT_ADDR A:0xe000100c
y.create.l HWIO_RPM_M3_DWT_DWT_SLEEPCNT_ADDR A:0xe0001010
y.create.l HWIO_RPM_M3_DWT_DWT_LSUCNT_ADDR A:0xe0001014
y.create.l HWIO_RPM_M3_DWT_DWT_FOLDCNT_ADDR A:0xe0001018
y.create.l HWIO_RPM_M3_DWT_DWT_PCSR_ADDR A:0xe000101c
y.create.l HWIO_RPM_M3_DWT_DWT_COMP0_ADDR A:0xe0001020
y.create.l HWIO_RPM_M3_DWT_DWT_MASK0_ADDR A:0xe0001024
y.create.l HWIO_RPM_M3_DWT_DWT_FUNCTION0_ADDR A:0xe0001028
y.create.l HWIO_RPM_M3_DWT_DWT_COMP1_ADDR A:0xe0001030
y.create.l HWIO_RPM_M3_DWT_DWT_MASK1_ADDR A:0xe0001034
y.create.l HWIO_RPM_M3_DWT_DWT_FUNCTION1_ADDR A:0xe0001038
y.create.l HWIO_RPM_M3_DWT_DWT_COMP2_ADDR A:0xe0001040
y.create.l HWIO_RPM_M3_DWT_DWT_MASK2_ADDR A:0xe0001044
y.create.l HWIO_RPM_M3_DWT_DWT_FUNCTION2_ADDR A:0xe0001048
y.create.l HWIO_RPM_M3_DWT_DWT_COMP3_ADDR A:0xe0001050
y.create.l HWIO_RPM_M3_DWT_DWT_MASK3_ADDR A:0xe0001054
y.create.l HWIO_RPM_M3_DWT_DWT_FUNCTION3_ADDR A:0xe0001058
y.create.l HWIO_RPM_M3_DWT_PID4_ADDR A:0xe0001fd0
y.create.l HWIO_RPM_M3_DWT_PID5_ADDR A:0xe0001fd4
y.create.l HWIO_RPM_M3_DWT_PID6_ADDR A:0xe0001fd8
y.create.l HWIO_RPM_M3_DWT_PID7_ADDR A:0xe0001fdc
y.create.l HWIO_RPM_M3_DWT_PID0_ADDR A:0xe0001fe0
y.create.l HWIO_RPM_M3_DWT_PID1_ADDR A:0xe0001fe4
y.create.l HWIO_RPM_M3_DWT_PID2_ADDR A:0xe0001fe8
y.create.l HWIO_RPM_M3_DWT_PID3_ADDR A:0xe0001fec
y.create.l HWIO_RPM_M3_DWT_CID0_ADDR A:0xe0001ff0
y.create.l HWIO_RPM_M3_DWT_CID1_ADDR A:0xe0001ff4
y.create.l HWIO_RPM_M3_DWT_CID2_ADDR A:0xe0001ff8
y.create.l HWIO_RPM_M3_DWT_CID3_ADDR A:0xe0001ffc
y.create.l HWIO_RPM_M3_FPB_FP_CTRL_ADDR A:0xe0002000
y.create.l HWIO_RPM_M3_FPB_FP_REMAP_ADDR A:0xe0002004
y.create.l HWIO_RPM_M3_FPB_FP_COMP0_ADDR A:0xe0002008
y.create.l HWIO_RPM_M3_FPB_FP_COMP1_ADDR A:0xe000200c
y.create.l HWIO_RPM_M3_FPB_FP_COMP2_ADDR A:0xe0002010
y.create.l HWIO_RPM_M3_FPB_FP_COMP3_ADDR A:0xe0002014
y.create.l HWIO_RPM_M3_FPB_FP_COMP4_ADDR A:0xe0002018
y.create.l HWIO_RPM_M3_FPB_FP_COMP5_ADDR A:0xe000201c
y.create.l HWIO_RPM_M3_FPB_FP_COMP6_ADDR A:0xe0002020
y.create.l HWIO_RPM_M3_FPB_FP_COMP7_ADDR A:0xe0002024
y.create.l HWIO_RPM_M3_FPB_PID4_ADDR A:0xe0002fd0
y.create.l HWIO_RPM_M3_FPB_PID5_ADDR A:0xe0002fd4
y.create.l HWIO_RPM_M3_FPB_PID6_ADDR A:0xe0002fd8
y.create.l HWIO_RPM_M3_FPB_PID7_ADDR A:0xe0002fdc
y.create.l HWIO_RPM_M3_FPB_PID0_ADDR A:0xe0002fe0
y.create.l HWIO_RPM_M3_FPB_PID1_ADDR A:0xe0002fe4
y.create.l HWIO_RPM_M3_FPB_PID2_ADDR A:0xe0002fe8
y.create.l HWIO_RPM_M3_FPB_PID3_ADDR A:0xe0002fec
y.create.l HWIO_RPM_M3_FPB_CID0_ADDR A:0xe0002ff0
y.create.l HWIO_RPM_M3_FPB_CID1_ADDR A:0xe0002ff4
y.create.l HWIO_RPM_M3_FPB_CID2_ADDR A:0xe0002ff8
y.create.l HWIO_RPM_M3_FPB_CID3_ADDR A:0xe0002ffc
y.create.l HWIO_RPM_M3_SCS_ICTR_ADDR A:0xe000e004
y.create.l HWIO_RPM_M3_SCS_ACTLR_ADDR A:0xe000e008
y.create.l HWIO_RPM_M3_SCS_STCSR_ADDR A:0xe000e010
y.create.l HWIO_RPM_M3_SCS_STRVR_ADDR A:0xe000e014
y.create.l HWIO_RPM_M3_SCS_STCVR_ADDR A:0xe000e018
y.create.l HWIO_RPM_M3_SCS_STCR_ADDR A:0xe000e01c
y.create.l HWIO_RPM_M3_SCS_NVIC_ISER0_ADDR A:0xe000e100
y.create.l HWIO_RPM_M3_SCS_NVIC_ISER1_ADDR A:0xe000e104
y.create.l HWIO_RPM_M3_SCS_NVIC_ICER0_ADDR A:0xe000e180
y.create.l HWIO_RPM_M3_SCS_NVIC_ICER1_ADDR A:0xe000e184
y.create.l HWIO_RPM_M3_SCS_NVIC_ISPR0_ADDR A:0xe000e200
y.create.l HWIO_RPM_M3_SCS_NVIC_ISPR1_ADDR A:0xe000e204
y.create.l HWIO_RPM_M3_SCS_NVIC_ICPR0_ADDR A:0xe000e280
y.create.l HWIO_RPM_M3_SCS_NVIC_ICPR1_ADDR A:0xe000e284
y.create.l HWIO_RPM_M3_SCS_NVIC_IABR0_ADDR A:0xe000e300
y.create.l HWIO_RPM_M3_SCS_NVIC_IABR1_ADDR A:0xe000e304
y.create.l HWIO_RPM_M3_SCS_NVIC_IPR0_ADDR A:0xe000e400
y.create.l HWIO_RPM_M3_SCS_NVIC_IPR1_ADDR A:0xe000e404
y.create.l HWIO_RPM_M3_SCS_NVIC_IPR2_ADDR A:0xe000e408
y.create.l HWIO_RPM_M3_SCS_NVIC_IPR3_ADDR A:0xe000e40c
y.create.l HWIO_RPM_M3_SCS_NVIC_IPR4_ADDR A:0xe000e410
y.create.l HWIO_RPM_M3_SCS_NVIC_IPR5_ADDR A:0xe000e414
y.create.l HWIO_RPM_M3_SCS_NVIC_IPR6_ADDR A:0xe000e418
y.create.l HWIO_RPM_M3_SCS_NVIC_IPR7_ADDR A:0xe000e41c
y.create.l HWIO_RPM_M3_SCS_NVIC_IPR8_ADDR A:0xe000e420
y.create.l HWIO_RPM_M3_SCS_NVIC_IPR9_ADDR A:0xe000e424
y.create.l HWIO_RPM_M3_SCS_NVIC_IPR10_ADDR A:0xe000e428
y.create.l HWIO_RPM_M3_SCS_NVIC_IPR11_ADDR A:0xe000e42c
y.create.l HWIO_RPM_M3_SCS_NVIC_IPR12_ADDR A:0xe000e430
y.create.l HWIO_RPM_M3_SCS_NVIC_IPR13_ADDR A:0xe000e434
y.create.l HWIO_RPM_M3_SCS_NVIC_IPR14_ADDR A:0xe000e438
y.create.l HWIO_RPM_M3_SCS_NVIC_IPR15_ADDR A:0xe000e43c
y.create.l HWIO_RPM_M3_SCS_CPUID_ADDR A:0xe000ed00
y.create.l HWIO_RPM_M3_SCS_ICSR_ADDR A:0xe000ed04
y.create.l HWIO_RPM_M3_SCS_VTOR_ADDR A:0xe000ed08
y.create.l HWIO_RPM_M3_SCS_AIRCR_ADDR A:0xe000ed0c
y.create.l HWIO_RPM_M3_SCS_SCR_ADDR A:0xe000ed10
y.create.l HWIO_RPM_M3_SCS_CCR_ADDR A:0xe000ed14
y.create.l HWIO_RPM_M3_SCS_SHPR1_ADDR A:0xe000ed18
y.create.l HWIO_RPM_M3_SCS_SHPR2_ADDR A:0xe000ed1c
y.create.l HWIO_RPM_M3_SCS_SHPR3_ADDR A:0xe000ed20
y.create.l HWIO_RPM_M3_SCS_SHCSR_ADDR A:0xe000ed24
y.create.l HWIO_RPM_M3_SCS_CFSR_ADDR A:0xe000ed28
y.create.l HWIO_RPM_M3_SCS_HFSR_ADDR A:0xe000ed2c
y.create.l HWIO_RPM_M3_SCS_DFSR_ADDR A:0xe000ed30
y.create.l HWIO_RPM_M3_SCS_MMFAR_ADDR A:0xe000ed34
y.create.l HWIO_RPM_M3_SCS_BFAR_ADDR A:0xe000ed38
y.create.l HWIO_RPM_M3_SCS_AFSR_ADDR A:0xe000ed3c
y.create.l HWIO_RPM_M3_SCS_ID_PFR0_ADDR A:0xe000ed40
y.create.l HWIO_RPM_M3_SCS_ID_PFR1_ADDR A:0xe000ed44
y.create.l HWIO_RPM_M3_SCS_ID_DFR0_ADDR A:0xe000ed48
y.create.l HWIO_RPM_M3_SCS_ID_AFR0_ADDR A:0xe000ed4c
y.create.l HWIO_RPM_M3_SCS_ID_MMFR0_ADDR A:0xe000ed50
y.create.l HWIO_RPM_M3_SCS_ID_MMFR1_ADDR A:0xe000ed54
y.create.l HWIO_RPM_M3_SCS_ID_MMFR2_ADDR A:0xe000ed58
y.create.l HWIO_RPM_M3_SCS_ID_MMFR3_ADDR A:0xe000ed5c
y.create.l HWIO_RPM_M3_SCS_ID_ISAR0_ADDR A:0xe000ed60
y.create.l HWIO_RPM_M3_SCS_ID_ISAR1_ADDR A:0xe000ed64
y.create.l HWIO_RPM_M3_SCS_ID_ISAR2_ADDR A:0xe000ed68
y.create.l HWIO_RPM_M3_SCS_ID_ISAR3_ADDR A:0xe000ed6c
y.create.l HWIO_RPM_M3_SCS_ID_ISAR4_ADDR A:0xe000ed70
y.create.l HWIO_RPM_M3_SCS_CPACR_ADDR A:0xe000ed88
y.create.l HWIO_RPM_M3_SCS_MPU_TYPE_ADDR A:0xe000ed90
y.create.l HWIO_RPM_M3_SCS_MPU_CTRL_ADDR A:0xe000ed94
y.create.l HWIO_RPM_M3_SCS_MPU_RNR_ADDR A:0xe000ed98
y.create.l HWIO_RPM_M3_SCS_MPU_RBAR_ADDR A:0xe000ed9c
y.create.l HWIO_RPM_M3_SCS_MPU_RASR_ADDR A:0xe000eda0
y.create.l HWIO_RPM_M3_SCS_MPU_RBAR_A1_ADDR A:0xe000eda4
y.create.l HWIO_RPM_M3_SCS_MPU_RASR_A1_ADDR A:0xe000eda8
y.create.l HWIO_RPM_M3_SCS_MPU_RBAR_A2_ADDR A:0xe000edac
y.create.l HWIO_RPM_M3_SCS_MPU_RASR_A2_ADDR A:0xe000edb0
y.create.l HWIO_RPM_M3_SCS_MPU_RBAR_A3_ADDR A:0xe000edb4
y.create.l HWIO_RPM_M3_SCS_MPU_RASR_A3_ADDR A:0xe000edb8
y.create.l HWIO_RPM_M3_SCS_DHCSR_ADDR A:0xe000edf0
y.create.l HWIO_RPM_M3_SCS_DCRSR_ADDR A:0xe000edf4
y.create.l HWIO_RPM_M3_SCS_DCRDR_ADDR A:0xe000edf8
y.create.l HWIO_RPM_M3_SCS_DEMCR_ADDR A:0xe000edfc
y.create.l HWIO_RPM_M3_SCS_STIR_ADDR A:0xe000ef00
y.create.l HWIO_RPM_M3_SCS_PID4_ADDR A:0xe000efd0
y.create.l HWIO_RPM_M3_SCS_PID5_ADDR A:0xe000efd4
y.create.l HWIO_RPM_M3_SCS_PID6_ADDR A:0xe000efd8
y.create.l HWIO_RPM_M3_SCS_PID7_ADDR A:0xe000efdc
y.create.l HWIO_RPM_M3_SCS_PID0_ADDR A:0xe000efe0
y.create.l HWIO_RPM_M3_SCS_PID1_ADDR A:0xe000efe4
y.create.l HWIO_RPM_M3_SCS_PID2_ADDR A:0xe000efe8
y.create.l HWIO_RPM_M3_SCS_PID3_ADDR A:0xe000efec
y.create.l HWIO_RPM_M3_SCS_CID0_ADDR A:0xe000eff0
y.create.l HWIO_RPM_M3_SCS_CID1_ADDR A:0xe000eff4
y.create.l HWIO_RPM_M3_SCS_CID2_ADDR A:0xe000eff8
y.create.l HWIO_RPM_M3_SCS_CID3_ADDR A:0xe000effc
y.create.l HWIO_RPM_M3_ETM_ETMCR_ADDR A:0xe0041000
y.create.l HWIO_RPM_M3_ETM_ETMCCR_ADDR A:0xe0041004
y.create.l HWIO_RPM_M3_ETM_ETMTRIGGER_ADDR A:0xe0041008
y.create.l HWIO_RPM_M3_ETM_ETMSR_ADDR A:0xe0041010
y.create.l HWIO_RPM_M3_ETM_ETMSCR_ADDR A:0xe0041014
y.create.l HWIO_RPM_M3_ETM_ETMTEEVR_ADDR A:0xe0041020
y.create.l HWIO_RPM_M3_ETM_ETMTECR1_ADDR A:0xe0041024
y.create.l HWIO_RPM_M3_ETM_ETMFFLR_ADDR A:0xe0041028
y.create.l HWIO_RPM_M3_ETM_ETMCNTRLDVR1_ADDR A:0xe0041140
y.create.l HWIO_RPM_M3_ETM_ETMSYNCFR_ADDR A:0xe00411e0
y.create.l HWIO_RPM_M3_ETM_ETMIDR_ADDR A:0xe00411e4
y.create.l HWIO_RPM_M3_ETM_ETMCCER_ADDR A:0xe00411e8
y.create.l HWIO_RPM_M3_ETM_ETMTESSEICR_ADDR A:0xe00411f0
y.create.l HWIO_RPM_M3_ETM_ETMTSEVR_ADDR A:0xe00411f8
y.create.l HWIO_RPM_M3_ETM_ETMTRACEIDR_ADDR A:0xe0041200
y.create.l HWIO_RPM_M3_ETM_ETMIDR2_ADDR A:0xe0041208
y.create.l HWIO_RPM_M3_ETM_ETMPDSR_ADDR A:0xe0041314
y.create.l HWIO_RPM_M3_ETM_ITMISCIN_ADDR A:0xe0041ee0
y.create.l HWIO_RPM_M3_ETM_ITTRIGOUT_ADDR A:0xe0041ee8
y.create.l HWIO_RPM_M3_ETM_ETM_ITATBCTR2_ADDR A:0xe0041ef0
y.create.l HWIO_RPM_M3_ETM_ETM_ITATBCTR0_ADDR A:0xe0041ef8
y.create.l HWIO_RPM_M3_ETM_ETMITCTRL_ADDR A:0xe0041f00
y.create.l HWIO_RPM_M3_ETM_ETMCLAIMSET_ADDR A:0xe0041fa0
y.create.l HWIO_RPM_M3_ETM_ETMCLAIMCLR_ADDR A:0xe0041fa4
y.create.l HWIO_RPM_M3_ETM_ETMLAR_ADDR A:0xe0041fb0
y.create.l HWIO_RPM_M3_ETM_ETMLSR_ADDR A:0xe0041fb4
y.create.l HWIO_RPM_M3_ETM_ETMAUTHSTATUS_ADDR A:0xe0041fb8
y.create.l HWIO_RPM_M3_ETM_ETMDEVTYPE_ADDR A:0xe0041fcc
y.create.l HWIO_RPM_M3_ETM_ETMPID4_ADDR A:0xe0041fd0
y.create.l HWIO_RPM_M3_ETM_ETMPID5_ADDR A:0xe0041fd4
y.create.l HWIO_RPM_M3_ETM_ETMPID6_ADDR A:0xe0041fd8
y.create.l HWIO_RPM_M3_ETM_ETMPID7_ADDR A:0xe0041fdc
y.create.l HWIO_RPM_M3_ETM_ETMPID0_ADDR A:0xe0041fe0
y.create.l HWIO_RPM_M3_ETM_ETMPID1_ADDR A:0xe0041fe4
y.create.l HWIO_RPM_M3_ETM_ETMPID2_ADDR A:0xe0041fe8
y.create.l HWIO_RPM_M3_ETM_ETMPID3_ADDR A:0xe0041fec
y.create.l HWIO_RPM_M3_ETM_ETMCID0_ADDR A:0xe0041ff0
y.create.l HWIO_RPM_M3_ETM_ETMCID1_ADDR A:0xe0041ff4
y.create.l HWIO_RPM_M3_ETM_ETMCID2_ADDR A:0xe0041ff8
y.create.l HWIO_RPM_M3_ETM_ETMCID3_ADDR A:0xe0041ffc
y.create.l HWIO_RPM_M3_ROM_TABLE_SCS_ADDR A:0xe00ff000
y.create.l HWIO_RPM_M3_ROM_TABLE_DWT_ADDR A:0xe00ff004
y.create.l HWIO_RPM_M3_ROM_TABLE_FPB_ADDR A:0xe00ff008
y.create.l HWIO_RPM_M3_ROM_TABLE_ITM_ADDR A:0xe00ff00c
y.create.l HWIO_RPM_M3_ROM_TABLE_TPIU_ADDR A:0xe00ff010
y.create.l HWIO_RPM_M3_ROM_TABLE_ETM_ADDR A:0xe00ff014
y.create.l HWIO_RPM_M3_ROM_TABLE_END_ADDR A:0xe00ff018
y.create.l HWIO_RPM_M3_ROM_TABLE_SYSTEM_ACCESS_ADDR A:0xe00fffcc
y.create.l HWIO_RPM_M3_ROM_TABLE_PID4_ADDR A:0xe00fffd0
y.create.l HWIO_RPM_M3_ROM_TABLE_PID5_ADDR A:0xe00fffd4
y.create.l HWIO_RPM_M3_ROM_TABLE_PID6_ADDR A:0xe00fffd8
y.create.l HWIO_RPM_M3_ROM_TABLE_PID7_ADDR A:0xe00fffdc
y.create.l HWIO_RPM_M3_ROM_TABLE_PID0_ADDR A:0xe00fffe0
y.create.l HWIO_RPM_M3_ROM_TABLE_PID1_ADDR A:0xe00fffe4
y.create.l HWIO_RPM_M3_ROM_TABLE_PID2_ADDR A:0xe00fffe8
y.create.l HWIO_RPM_M3_ROM_TABLE_PID3_ADDR A:0xe00fffec
y.create.l HWIO_RPM_M3_ROM_TABLE_CID0_ADDR A:0xe00ffff0
y.create.l HWIO_RPM_M3_ROM_TABLE_CID1_ADDR A:0xe00ffff4
y.create.l HWIO_RPM_M3_ROM_TABLE_CID2_ADDR A:0xe00ffff8
y.create.l HWIO_RPM_M3_ROM_TABLE_CID3_ADDR A:0xe00ffffc
y.create.l HWIO_SDC1_SDCC_MCI_POWER_ADDR A:0x67824000
y.create.l HWIO_SDC1_SDCC_MCI_CLK_ADDR A:0x67824004
y.create.l HWIO_SDC1_SDCC_MCI_ARGUMENT_ADDR A:0x67824008
y.create.l HWIO_SDC1_SDCC_MCI_CMD_ADDR A:0x6782400c
y.create.l HWIO_SDC1_SDCC_MCI_RESP_CMD_ADDR A:0x67824010
y.create.l HWIO_SDC1_SDCC_MCI_RESP0_ADDR A:0x67824014
y.create.l HWIO_SDC1_SDCC_MCI_RESP1_ADDR A:0x67824018
y.create.l HWIO_SDC1_SDCC_MCI_RESP2_ADDR A:0x6782401c
y.create.l HWIO_SDC1_SDCC_MCI_RESP3_ADDR A:0x67824020
y.create.l HWIO_SDC1_SDCC_MCI_DATA_TIMER_ADDR A:0x67824024
y.create.l HWIO_SDC1_SDCC_MCI_DATA_LENGTH_ADDR A:0x67824028
y.create.l HWIO_SDC1_SDCC_MCI_DATA_CTL_ADDR A:0x6782402c
y.create.l HWIO_SDC1_SDCC_MCI_DATA_COUNT_ADDR A:0x67824030
y.create.l HWIO_SDC1_SDCC_MCI_STATUS_ADDR A:0x67824034
y.create.l HWIO_SDC1_SDCC_MCI_CLEAR_ADDR A:0x67824038
y.create.l HWIO_SDC1_SDCC_MCI_INT_MASK0_ADDR A:0x6782403c
y.create.l HWIO_SDC1_SDCC_MCI_INT_MASK1_ADDR A:0x67824040
y.create.l HWIO_SDC1_SDCC_MCI_FIFO_COUNT_ADDR A:0x67824044
y.create.l HWIO_SDC1_SDCC_MCI_BOOT_ADDR A:0x67824048
y.create.l HWIO_SDC1_SDCC_MCI_BOOT_ACK_TIMER_ADDR A:0x6782404c
y.create.l HWIO_SDC1_SDCC_MCI_VERSION_ADDR A:0x67824050
y.create.l HWIO_SDC1_SDCC_MCI_EMULATION_DLY_LINE_ADDR A:0x67824054
y.create.l HWIO_SDC1_SDCC_MCI_CCS_TIMER_ADDR A:0x67824058
y.create.l HWIO_SDC1_SDCC_MCI_RESPONSE_MASK_ADDR A:0x6782405c
y.create.l HWIO_SDC1_SDCC_MCI_DLL_CONFIG_ADDR A:0x67824060
y.create.l HWIO_SDC1_SDCC_MCI_DLL_TEST_CTL_ADDR A:0x67824064
y.create.l HWIO_SDC1_SDCC_MCI_DLL_STATUS_ADDR A:0x67824068
y.create.l HWIO_SDC1_SDCC_MCI_STATUS2_ADDR A:0x6782406c
y.create.l HWIO_SDC1_SDCC_MCI_GENERICS_ADDR A:0x67824070
y.create.l HWIO_SDC1_SDCC_MCI_FIFO_STATUS_ADDR A:0x67824074
y.create.l HWIO_SDC1_SDCC_MCI_HC_MODE_ADDR A:0x67824078
y.create.l HWIO_SDC1_SDCC_MCI_FIFO0_ADDR A:0x67824080
y.create.l HWIO_SDC1_SDCC_MCI_FIFO1_ADDR A:0x67824084
y.create.l HWIO_SDC1_SDCC_MCI_FIFO2_ADDR A:0x67824088
y.create.l HWIO_SDC1_SDCC_MCI_FIFO3_ADDR A:0x6782408c
y.create.l HWIO_SDC1_SDCC_MCI_FIFO4_ADDR A:0x67824090
y.create.l HWIO_SDC1_SDCC_MCI_FIFO5_ADDR A:0x67824094
y.create.l HWIO_SDC1_SDCC_MCI_FIFO6_ADDR A:0x67824098
y.create.l HWIO_SDC1_SDCC_MCI_FIFO7_ADDR A:0x6782409c
y.create.l HWIO_SDC1_SDCC_MCI_FIFO8_ADDR A:0x678240a0
y.create.l HWIO_SDC1_SDCC_MCI_FIFO9_ADDR A:0x678240a4
y.create.l HWIO_SDC1_SDCC_MCI_TESTBUS_CONFIG_ADDR A:0x678240cc
y.create.l HWIO_SDC1_SDCC_MCI_TEST_CTL_ADDR A:0x678240d0
y.create.l HWIO_SDC1_SDCC_MCI_TEST_INPUT_ADDR A:0x678240d4
y.create.l HWIO_SDC1_SDCC_MCI_TEST_OUT_ADDR A:0x678240d8
y.create.l HWIO_SDC1_SDCC_MCI_PWRCTL_STATUS_REG_ADDR A:0x678240dc
y.create.l HWIO_SDC1_SDCC_MCI_PWRCTL_MASK_REG_ADDR A:0x678240e0
y.create.l HWIO_SDC1_SDCC_MCI_PWRCTL_CLEAR_REG_ADDR A:0x678240e4
y.create.l HWIO_SDC1_SDCC_MCI_PWRCTL_CTL_REG_ADDR A:0x678240e8
y.create.l HWIO_SDC1_SDCC_MCI_CLEAR2_ADDR A:0x678240ec
y.create.l HWIO_SDC1_SDCC_MCI_INT_MASKINT2_0_ADDR A:0x678240f0
y.create.l HWIO_SDC1_SDCC_MCI_INT_MASKINT2_1_ADDR A:0x678240f4
y.create.l HWIO_SDC1_SDCC_CHAR_CFG_ADDR A:0x678240fc
y.create.l HWIO_SDC1_SDCC_CHAR_CMD_ADDR A:0x67824100
y.create.l HWIO_SDC1_SDCC_CHAR_DATA_0_ADDR A:0x67824104
y.create.l HWIO_SDC1_SDCC_CHAR_DATA_1_ADDR A:0x67824108
y.create.l HWIO_SDC1_SDCC_CHAR_DATA_2_ADDR A:0x6782410c
y.create.l HWIO_SDC1_SDCC_CHAR_DATA_3_ADDR A:0x67824110
y.create.l HWIO_SDC1_SDCC_CHAR_DATA_4_ADDR A:0x67824114
y.create.l HWIO_SDC1_SDCC_CHAR_DATA_5_ADDR A:0x67824118
y.create.l HWIO_SDC1_SDCC_CHAR_DATA_6_ADDR A:0x6782411c
y.create.l HWIO_SDC1_SDCC_CHAR_DATA_7_ADDR A:0x67824120
y.create.l HWIO_SDC1_SDCC_DEBUG_REG_ADDR A:0x67824124
y.create.l HWIO_SDC1_SDCC_IP_CATALOG_ADDR A:0x67824128
y.create.l HWIO_SDC1_SDCC_QSB_VALUES_ADDR A:0x6782412c
y.create.l HWIO_SDC1_SDCC_QSB_AXI_VALUES_ADDR A:0x67824130
y.create.l HWIO_SDC1_SDCC_AXI_DATA_ERR_DBUG_ADDR A:0x67824134
y.create.l HWIO_SDC1_SDCC_T4_DLY_CTRL_ADDR A:0x67824138
y.create.l HWIO_SDC1_SDCC_T4_DLY_STAT_ADDR A:0x6782413c
y.create.l HWIO_SDC1_SDCC_CSR_CDC_CTLR_CFG0_ADDR A:0x67824140
y.create.l HWIO_SDC1_SDCC_CSR_CDC_CTLR_CFG1_ADDR A:0x67824144
y.create.l HWIO_SDC1_SDCC_CSR_CDC_CAL_TIMER_CFG0_ADDR A:0x67824148
y.create.l HWIO_SDC1_SDCC_CSR_CDC_CAL_TIMER_CFG1_ADDR A:0x6782414c
y.create.l HWIO_SDC1_SDCC_CSR_CDC_REFCOUNT_CFG_ADDR A:0x67824150
y.create.l HWIO_SDC1_SDCC_CSR_CDC_COARSE_CAL_CFG_ADDR A:0x67824154
y.create.l HWIO_SDC1_SDCC_CSR_CDC_RSVD_CFG_ADDR A:0x67824158
y.create.l HWIO_SDC1_SDCC_CSR_CDC_OFFSET_CFG_ADDR A:0x6782415c
y.create.l HWIO_SDC1_SDCC_CSR_CDC_DELAY_CFG_ADDR A:0x67824160
y.create.l HWIO_SDC1_SDCC_CSR_CDC_SW_MODE_CFG_ADDR A:0x67824164
y.create.l HWIO_SDC1_SDCC_CSR_CDC_TEST_CFG_ADDR A:0x67824168
y.create.l HWIO_SDC1_SDCC_CSR_CDC_SW_OVRD_CFG_ADDR A:0x6782416c
y.create.l HWIO_SDC1_SDCC_CSR_CDC_SLAVE_DDA_CFG_ADDR A:0x67824170
y.create.l HWIO_SDC1_SDCC_CSR_CDC_STATUS0_ADDR A:0x67824174
y.create.l HWIO_SDC1_SDCC_CSR_CDC_STATUS1_ADDR A:0x67824178
y.create.l HWIO_SDC1_SDCC_CSR_CDC_STATUS2_ADDR A:0x6782417c
y.create.l HWIO_SDC1_SDCC_CSR_CDC_STATUS3_ADDR A:0x67824180
y.create.l HWIO_SDC1_SDCC_CSR_CDC_STATUS4_ADDR A:0x67824184
y.create.l HWIO_SDC1_SDCC_CSR_CDC_GEN_CFG_ADDR A:0x67824188
y.create.l HWIO_SDC1_SDCC_CDC_AUTO_SW_CAL_CFG_ADDR A:0x6782418c
y.create.l HWIO_SDC1_SDCC_DDR200_STAT_ADDR A:0x67824190
y.create.l HWIO_SDC1_SDCC_DDR200_CFG_ADDR A:0x67824194
y.create.l HWIO_SDC1_SDCC_TIME_COUNT_CTRL_ADDR A:0x67824198
y.create.l HWIO_SDC1_SDCC_FLOW_CTRL_TIME_COUNT_ADDR A:0x6782419c
y.create.l HWIO_SDC1_SDCC_BUSY_TIME_COUNT_ADDR A:0x678241a0
y.create.l HWIO_SDC1_SDCC_DATA_TIME_COUNT_ADDR A:0x678241a4
y.create.l HWIO_SDC1_SDCC_CMD_TIME_COUNT_ADDR A:0x678241a8
y.create.l HWIO_SDC1_SDCC_MCI_DLL_CONFIG_2_ADDR A:0x678241ac
y.create.l HWIO_SDC1_SDCC_MCI_DDR_CONFIG_ADDR A:0x678241b0
y.create.l HWIO_SDC1_SDCC_MCI_FIFO_ALT0_ADDR A:0x67824400
y.create.l HWIO_SDC1_SDCC_MCI_FIFO_ALT1_ADDR A:0x67824404
y.create.l HWIO_SDC1_SDCC_MCI_FIFO_ALT2_ADDR A:0x67824408
y.create.l HWIO_SDC1_SDCC_MCI_FIFO_ALT3_ADDR A:0x6782440c
y.create.l HWIO_SDC1_SDCC_MCI_FIFO_ALT4_ADDR A:0x67824410
y.create.l HWIO_SDC1_SDCC_MCI_FIFO_ALT5_ADDR A:0x67824414
y.create.l HWIO_SDC1_SDCC_MCI_FIFO_ALT6_ADDR A:0x67824418
y.create.l HWIO_SDC1_SDCC_MCI_FIFO_ALT7_ADDR A:0x6782441c
y.create.l HWIO_SDC1_SDCC_MCI_FIFO_ALT8_ADDR A:0x67824420
y.create.l HWIO_SDC1_SDCC_MCI_FIFO_ALT9_ADDR A:0x67824424
y.create.l HWIO_SDC1_SDCC_HC_REG_0_2_ADDR A:0x67824900
y.create.l HWIO_SDC1_SDCC_HC_REG_4_6_ADDR A:0x67824904
y.create.l HWIO_SDC1_SDCC_HC_REG_8_A_ADDR A:0x67824908
y.create.l HWIO_SDC1_SDCC_HC_REG_C_E_ADDR A:0x6782490c
y.create.l HWIO_SDC1_SDCC_HC_REG_10_12_ADDR A:0x67824910
y.create.l HWIO_SDC1_SDCC_HC_REG_14_16_ADDR A:0x67824914
y.create.l HWIO_SDC1_SDCC_HC_REG_18_1A_ADDR A:0x67824918
y.create.l HWIO_SDC1_SDCC_HC_REG_1C_1E_ADDR A:0x6782491c
y.create.l HWIO_SDC1_SDCC_HC_REG_20_22_ADDR A:0x67824920
y.create.l HWIO_SDC1_SDCC_HC_REG_24_26_ADDR A:0x67824924
y.create.l HWIO_SDC1_SDCC_HC_REG_28_2A_ADDR A:0x67824928
y.create.l HWIO_SDC1_SDCC_HC_REG_2C_2E_ADDR A:0x6782492c
y.create.l HWIO_SDC1_SDCC_HC_REG_30_32_ADDR A:0x67824930
y.create.l HWIO_SDC1_SDCC_HC_REG_34_36_ADDR A:0x67824934
y.create.l HWIO_SDC1_SDCC_HC_REG_38_3A_ADDR A:0x67824938
y.create.l HWIO_SDC1_SDCC_HC_REG_3C_3E_ADDR A:0x6782493c
y.create.l HWIO_SDC1_SDCC_HC_REG_40_42_ADDR A:0x67824940
y.create.l HWIO_SDC1_SDCC_HC_REG_44_46_ADDR A:0x67824944
y.create.l HWIO_SDC1_SDCC_HC_REG_48_4A_ADDR A:0x67824948
y.create.l HWIO_SDC1_SDCC_HC_REG_50_52_ADDR A:0x67824950
y.create.l HWIO_SDC1_SDCC_HC_REG_54_56_ADDR A:0x67824954
y.create.l HWIO_SDC1_SDCC_HC_REG_58_5A_ADDR A:0x67824958
y.create.l HWIO_SDC1_SDCC_HC_REG_5C_5E_ADDR A:0x6782495c
y.create.l HWIO_SDC1_SDCC_HC_REG_60_62_ADDR A:0x67824960
y.create.l HWIO_SDC1_SDCC_HC_REG_64_66_ADDR A:0x67824964
y.create.l HWIO_SDC1_SDCC_HC_REG_68_6A_ADDR A:0x67824968
y.create.l HWIO_SDC1_SDCC_HC_REG_6C_6E_ADDR A:0x6782496c
y.create.l HWIO_SDC1_SDCC_HC_REG_E0_E2_ADDR A:0x678249e0
y.create.l HWIO_SDC1_SDCC_HC_REG_FC_FE_ADDR A:0x678249fc
y.create.l HWIO_SDC1_SDCC_HC_REG_DLL_CONFIG_ADDR A:0x67824a00
y.create.l HWIO_SDC1_SDCC_HC_REG_DLL_TEST_CTL_ADDR A:0x67824a04
y.create.l HWIO_SDC1_SDCC_HC_REG_DLL_STATUS_ADDR A:0x67824a08
y.create.l HWIO_SDC1_SDCC_HC_VENDOR_SPECIFIC_FUNC_ADDR A:0x67824a0c
y.create.l HWIO_SDC1_SDCC_HC_VENDOR_SPECIFIC_FUNC2_ADDR A:0x67824a10
y.create.l HWIO_SDC1_SDCC_HC_VENDOR_SPECIFIC_ADMA_ERR_ADDR0_ADDR A:0x67824a14
y.create.l HWIO_SDC1_SDCC_HC_VENDOR_SPECIFIC_ADMA_ERR_ADDR1_ADDR A:0x67824a18
y.create.l HWIO_SDC1_SDCC_HC_VENDOR_SPECIFIC_CAPABILITIES0_ADDR A:0x67824a1c
y.create.l HWIO_SDC1_SDCC_HC_VENDOR_SPECIFIC_CAPABILITIES1_ADDR A:0x67824a20
y.create.l HWIO_SDC1_SDCC_HC_VENDOR_SPECIFIC_T4_DLY_CTRL_ADDR A:0x67824a24
y.create.l HWIO_SDC1_SDCC_HC_VENDOR_SPECIFIC_T4_DLY_STAT_ADDR A:0x67824a28
y.create.l HWIO_SDC1_SDCC_HC_VENDOR_SPECIFIC_CSR_CDC_CTLR_CFG0_ADDR A:0x67824a30
y.create.l HWIO_SDC1_SDCC_HC_VENDOR_SPECIFIC_CSR_CDC_CTLR_CFG1_ADDR A:0x67824a34
y.create.l HWIO_SDC1_SDCC_HC_VENDOR_SPECIFIC_CSR_CDC_CAL_TIMER_CFG0_ADDR A:0x67824a38
y.create.l HWIO_SDC1_SDCC_HC_VENDOR_SPECIFIC_CSR_CDC_CAL_TIMER_CFG1_ADDR A:0x67824a3c
y.create.l HWIO_SDC1_SDCC_HC_VENDOR_SPECIFIC_CSR_CDC_REFCOUNT_CFG_ADDR A:0x67824a40
y.create.l HWIO_SDC1_SDCC_HC_VENDOR_SPECIFIC_CSR_CDC_COARSE_CAL_CFG_ADDR A:0x67824a44
y.create.l HWIO_SDC1_SDCC_HC_VENDOR_SPECIFIC_CSR_CDC_RSVD_CFG_ADDR A:0x67824a48
y.create.l HWIO_SDC1_SDCC_HC_VENDOR_SPECIFIC_CSR_CDC_OFFSET_CFG_ADDR A:0x67824a4c
y.create.l HWIO_SDC1_SDCC_HC_VENDOR_SPECIFIC_CSR_CDC_DELAY_CFG_ADDR A:0x67824a50
y.create.l HWIO_SDC1_SDCC_HC_VENDOR_SPECIFIC_CSR_CDC_SW_MODE_CFG_ADDR A:0x67824a54
y.create.l HWIO_SDC1_SDCC_HC_VENDOR_SPECIFIC_CSR_CDC_TEST_CFG_ADDR A:0x67824a58
y.create.l HWIO_SDC1_SDCC_HC_VENDOR_SPECIFIC_CSR_CDC_SW_OVRD_CFG_ADDR A:0x67824a5c
y.create.l HWIO_SDC1_SDCC_HC_VENDOR_SPECIFIC_CSR_CDC_SLAVE_DDA_CFG_ADDR A:0x67824a60
y.create.l HWIO_SDC1_SDCC_HC_VENDOR_SPECIFIC_CSR_CDC_STATUS0_ADDR A:0x67824a64
y.create.l HWIO_SDC1_SDCC_HC_VENDOR_SPECIFIC_CSR_CDC_STATUS1_ADDR A:0x67824a68
y.create.l HWIO_SDC1_SDCC_HC_VENDOR_SPECIFIC_CSR_CDC_STATUS2_ADDR A:0x67824a6c
y.create.l HWIO_SDC1_SDCC_HC_VENDOR_SPECIFIC_CSR_CDC_STATUS3_ADDR A:0x67824a70
y.create.l HWIO_SDC1_SDCC_HC_VENDOR_SPECIFIC_CSR_CDC_STATUS4_ADDR A:0x67824a74
y.create.l HWIO_SDC1_SDCC_HC_VENDOR_SPECIFIC_CSR_CDC_GEN_CFG_ADDR A:0x67824a78
y.create.l HWIO_SDC1_SDCC_HC_VENDOR_SPECIFIC_CDC_AUTO_SW_CAL_CFG_ADDR A:0x67824a7c
y.create.l HWIO_SDC1_SDCC_HC_VENDOR_SPECIFIC_DDR200_STAT_ADDR A:0x67824a80
y.create.l HWIO_SDC1_SDCC_HC_VENDOR_SPECIFIC_DDR200_CFG_ADDR A:0x67824a84
y.create.l HWIO_SDC1_SDCC_HC_VENDOR_SPECIFIC_TIME_COUNT_CTRL_ADDR A:0x67824a88
y.create.l HWIO_SDC1_SDCC_HC_VENDOR_SPECIFIC_FLOW_CTRL_TIME_COUNT_ADDR A:0x67824a8c
y.create.l HWIO_SDC1_SDCC_HC_VENDOR_SPECIFIC_BUSY_TIME_COUNT_ADDR A:0x67824a90
y.create.l HWIO_SDC1_SDCC_HC_VENDOR_SPECIFIC_DATA_TIME_COUNT_ADDR A:0x67824a94
y.create.l HWIO_SDC1_SDCC_HC_VENDOR_SPECIFIC_CMD_TIME_COUNT_ADDR A:0x67824a98
y.create.l HWIO_SDC1_SDCC_HC_VENDOR_SPECIFIC_ERR_INT_STS_ADDR A:0x67824a9c
y.create.l HWIO_SDC1_SDCC_HC_VENDOR_SPECIFIC_PWRCTL_STATUS_REG_ADDR A:0x67824aa0
y.create.l HWIO_SDC1_SDCC_HC_VENDOR_SPECIFIC_PWRCTL_MASK_REG_ADDR A:0x67824aa4
y.create.l HWIO_SDC1_SDCC_HC_VENDOR_SPECIFIC_PWRCTL_CLEAR_REG_ADDR A:0x67824aa8
y.create.l HWIO_SDC1_SDCC_HC_VENDOR_SPECIFIC_PWRCTL_CTL_REG_ADDR A:0x67824aac
y.create.l HWIO_SDC1_SDCC_HC_VENDOR_SPECIFIC_FUNC3_ADDR A:0x67824ab0
y.create.l HWIO_SDC1_SDCC_HC_REG_DLL_CONFIG_2_ADDR A:0x67824ab4
y.create.l HWIO_SDC1_SDCC_HC_REG_DDR_CONFIG_ADDR A:0x67824ab8
y.create.l HWIO_SDC2_SDCC_MCI_POWER_ADDR A:0x67864000
y.create.l HWIO_SDC2_SDCC_MCI_CLK_ADDR A:0x67864004
y.create.l HWIO_SDC2_SDCC_MCI_ARGUMENT_ADDR A:0x67864008
y.create.l HWIO_SDC2_SDCC_MCI_CMD_ADDR A:0x6786400c
y.create.l HWIO_SDC2_SDCC_MCI_RESP_CMD_ADDR A:0x67864010
y.create.l HWIO_SDC2_SDCC_MCI_RESP0_ADDR A:0x67864014
y.create.l HWIO_SDC2_SDCC_MCI_RESP1_ADDR A:0x67864018
y.create.l HWIO_SDC2_SDCC_MCI_RESP2_ADDR A:0x6786401c
y.create.l HWIO_SDC2_SDCC_MCI_RESP3_ADDR A:0x67864020
y.create.l HWIO_SDC2_SDCC_MCI_DATA_TIMER_ADDR A:0x67864024
y.create.l HWIO_SDC2_SDCC_MCI_DATA_LENGTH_ADDR A:0x67864028
y.create.l HWIO_SDC2_SDCC_MCI_DATA_CTL_ADDR A:0x6786402c
y.create.l HWIO_SDC2_SDCC_MCI_DATA_COUNT_ADDR A:0x67864030
y.create.l HWIO_SDC2_SDCC_MCI_STATUS_ADDR A:0x67864034
y.create.l HWIO_SDC2_SDCC_MCI_CLEAR_ADDR A:0x67864038
y.create.l HWIO_SDC2_SDCC_MCI_INT_MASK0_ADDR A:0x6786403c
y.create.l HWIO_SDC2_SDCC_MCI_INT_MASK1_ADDR A:0x67864040
y.create.l HWIO_SDC2_SDCC_MCI_FIFO_COUNT_ADDR A:0x67864044
y.create.l HWIO_SDC2_SDCC_MCI_BOOT_ADDR A:0x67864048
y.create.l HWIO_SDC2_SDCC_MCI_BOOT_ACK_TIMER_ADDR A:0x6786404c
y.create.l HWIO_SDC2_SDCC_MCI_VERSION_ADDR A:0x67864050
y.create.l HWIO_SDC2_SDCC_MCI_EMULATION_DLY_LINE_ADDR A:0x67864054
y.create.l HWIO_SDC2_SDCC_MCI_CCS_TIMER_ADDR A:0x67864058
y.create.l HWIO_SDC2_SDCC_MCI_RESPONSE_MASK_ADDR A:0x6786405c
y.create.l HWIO_SDC2_SDCC_MCI_DLL_CONFIG_ADDR A:0x67864060
y.create.l HWIO_SDC2_SDCC_MCI_DLL_TEST_CTL_ADDR A:0x67864064
y.create.l HWIO_SDC2_SDCC_MCI_DLL_STATUS_ADDR A:0x67864068
y.create.l HWIO_SDC2_SDCC_MCI_STATUS2_ADDR A:0x6786406c
y.create.l HWIO_SDC2_SDCC_MCI_GENERICS_ADDR A:0x67864070
y.create.l HWIO_SDC2_SDCC_MCI_FIFO_STATUS_ADDR A:0x67864074
y.create.l HWIO_SDC2_SDCC_MCI_HC_MODE_ADDR A:0x67864078
y.create.l HWIO_SDC2_SDCC_MCI_FIFO0_ADDR A:0x67864080
y.create.l HWIO_SDC2_SDCC_MCI_FIFO1_ADDR A:0x67864084
y.create.l HWIO_SDC2_SDCC_MCI_FIFO2_ADDR A:0x67864088
y.create.l HWIO_SDC2_SDCC_MCI_FIFO3_ADDR A:0x6786408c
y.create.l HWIO_SDC2_SDCC_MCI_FIFO4_ADDR A:0x67864090
y.create.l HWIO_SDC2_SDCC_MCI_FIFO5_ADDR A:0x67864094
y.create.l HWIO_SDC2_SDCC_MCI_FIFO6_ADDR A:0x67864098
y.create.l HWIO_SDC2_SDCC_MCI_FIFO7_ADDR A:0x6786409c
y.create.l HWIO_SDC2_SDCC_MCI_FIFO8_ADDR A:0x678640a0
y.create.l HWIO_SDC2_SDCC_MCI_FIFO9_ADDR A:0x678640a4
y.create.l HWIO_SDC2_SDCC_MCI_TESTBUS_CONFIG_ADDR A:0x678640cc
y.create.l HWIO_SDC2_SDCC_MCI_TEST_CTL_ADDR A:0x678640d0
y.create.l HWIO_SDC2_SDCC_MCI_TEST_INPUT_ADDR A:0x678640d4
y.create.l HWIO_SDC2_SDCC_MCI_TEST_OUT_ADDR A:0x678640d8
y.create.l HWIO_SDC2_SDCC_MCI_PWRCTL_STATUS_REG_ADDR A:0x678640dc
y.create.l HWIO_SDC2_SDCC_MCI_PWRCTL_MASK_REG_ADDR A:0x678640e0
y.create.l HWIO_SDC2_SDCC_MCI_PWRCTL_CLEAR_REG_ADDR A:0x678640e4
y.create.l HWIO_SDC2_SDCC_MCI_PWRCTL_CTL_REG_ADDR A:0x678640e8
y.create.l HWIO_SDC2_SDCC_MCI_CLEAR2_ADDR A:0x678640ec
y.create.l HWIO_SDC2_SDCC_MCI_INT_MASKINT2_0_ADDR A:0x678640f0
y.create.l HWIO_SDC2_SDCC_MCI_INT_MASKINT2_1_ADDR A:0x678640f4
y.create.l HWIO_SDC2_SDCC_CHAR_CFG_ADDR A:0x678640fc
y.create.l HWIO_SDC2_SDCC_CHAR_CMD_ADDR A:0x67864100
y.create.l HWIO_SDC2_SDCC_CHAR_DATA_0_ADDR A:0x67864104
y.create.l HWIO_SDC2_SDCC_CHAR_DATA_1_ADDR A:0x67864108
y.create.l HWIO_SDC2_SDCC_CHAR_DATA_2_ADDR A:0x6786410c
y.create.l HWIO_SDC2_SDCC_CHAR_DATA_3_ADDR A:0x67864110
y.create.l HWIO_SDC2_SDCC_CHAR_DATA_4_ADDR A:0x67864114
y.create.l HWIO_SDC2_SDCC_CHAR_DATA_5_ADDR A:0x67864118
y.create.l HWIO_SDC2_SDCC_CHAR_DATA_6_ADDR A:0x6786411c
y.create.l HWIO_SDC2_SDCC_CHAR_DATA_7_ADDR A:0x67864120
y.create.l HWIO_SDC2_SDCC_DEBUG_REG_ADDR A:0x67864124
y.create.l HWIO_SDC2_SDCC_IP_CATALOG_ADDR A:0x67864128
y.create.l HWIO_SDC2_SDCC_QSB_VALUES_ADDR A:0x6786412c
y.create.l HWIO_SDC2_SDCC_QSB_AXI_VALUES_ADDR A:0x67864130
y.create.l HWIO_SDC2_SDCC_AXI_DATA_ERR_DBUG_ADDR A:0x67864134
y.create.l HWIO_SDC2_SDCC_T4_DLY_CTRL_ADDR A:0x67864138
y.create.l HWIO_SDC2_SDCC_T4_DLY_STAT_ADDR A:0x6786413c
y.create.l HWIO_SDC2_SDCC_CSR_CDC_CTLR_CFG0_ADDR A:0x67864140
y.create.l HWIO_SDC2_SDCC_CSR_CDC_CTLR_CFG1_ADDR A:0x67864144
y.create.l HWIO_SDC2_SDCC_CSR_CDC_CAL_TIMER_CFG0_ADDR A:0x67864148
y.create.l HWIO_SDC2_SDCC_CSR_CDC_CAL_TIMER_CFG1_ADDR A:0x6786414c
y.create.l HWIO_SDC2_SDCC_CSR_CDC_REFCOUNT_CFG_ADDR A:0x67864150
y.create.l HWIO_SDC2_SDCC_CSR_CDC_COARSE_CAL_CFG_ADDR A:0x67864154
y.create.l HWIO_SDC2_SDCC_CSR_CDC_RSVD_CFG_ADDR A:0x67864158
y.create.l HWIO_SDC2_SDCC_CSR_CDC_OFFSET_CFG_ADDR A:0x6786415c
y.create.l HWIO_SDC2_SDCC_CSR_CDC_DELAY_CFG_ADDR A:0x67864160
y.create.l HWIO_SDC2_SDCC_CSR_CDC_SW_MODE_CFG_ADDR A:0x67864164
y.create.l HWIO_SDC2_SDCC_CSR_CDC_TEST_CFG_ADDR A:0x67864168
y.create.l HWIO_SDC2_SDCC_CSR_CDC_SW_OVRD_CFG_ADDR A:0x6786416c
y.create.l HWIO_SDC2_SDCC_CSR_CDC_SLAVE_DDA_CFG_ADDR A:0x67864170
y.create.l HWIO_SDC2_SDCC_CSR_CDC_STATUS0_ADDR A:0x67864174
y.create.l HWIO_SDC2_SDCC_CSR_CDC_STATUS1_ADDR A:0x67864178
y.create.l HWIO_SDC2_SDCC_CSR_CDC_STATUS2_ADDR A:0x6786417c
y.create.l HWIO_SDC2_SDCC_CSR_CDC_STATUS3_ADDR A:0x67864180
y.create.l HWIO_SDC2_SDCC_CSR_CDC_STATUS4_ADDR A:0x67864184
y.create.l HWIO_SDC2_SDCC_CSR_CDC_GEN_CFG_ADDR A:0x67864188
y.create.l HWIO_SDC2_SDCC_CDC_AUTO_SW_CAL_CFG_ADDR A:0x6786418c
y.create.l HWIO_SDC2_SDCC_DDR200_STAT_ADDR A:0x67864190
y.create.l HWIO_SDC2_SDCC_DDR200_CFG_ADDR A:0x67864194
y.create.l HWIO_SDC2_SDCC_TIME_COUNT_CTRL_ADDR A:0x67864198
y.create.l HWIO_SDC2_SDCC_FLOW_CTRL_TIME_COUNT_ADDR A:0x6786419c
y.create.l HWIO_SDC2_SDCC_BUSY_TIME_COUNT_ADDR A:0x678641a0
y.create.l HWIO_SDC2_SDCC_DATA_TIME_COUNT_ADDR A:0x678641a4
y.create.l HWIO_SDC2_SDCC_CMD_TIME_COUNT_ADDR A:0x678641a8
y.create.l HWIO_SDC2_SDCC_MCI_DLL_CONFIG_2_ADDR A:0x678641ac
y.create.l HWIO_SDC2_SDCC_MCI_DDR_CONFIG_ADDR A:0x678641b0
y.create.l HWIO_SDC2_SDCC_MCI_FIFO_ALT0_ADDR A:0x67864400
y.create.l HWIO_SDC2_SDCC_MCI_FIFO_ALT1_ADDR A:0x67864404
y.create.l HWIO_SDC2_SDCC_MCI_FIFO_ALT2_ADDR A:0x67864408
y.create.l HWIO_SDC2_SDCC_MCI_FIFO_ALT3_ADDR A:0x6786440c
y.create.l HWIO_SDC2_SDCC_MCI_FIFO_ALT4_ADDR A:0x67864410
y.create.l HWIO_SDC2_SDCC_MCI_FIFO_ALT5_ADDR A:0x67864414
y.create.l HWIO_SDC2_SDCC_MCI_FIFO_ALT6_ADDR A:0x67864418
y.create.l HWIO_SDC2_SDCC_MCI_FIFO_ALT7_ADDR A:0x6786441c
y.create.l HWIO_SDC2_SDCC_MCI_FIFO_ALT8_ADDR A:0x67864420
y.create.l HWIO_SDC2_SDCC_MCI_FIFO_ALT9_ADDR A:0x67864424
y.create.l HWIO_SDC2_SDCC_HC_REG_0_2_ADDR A:0x67864900
y.create.l HWIO_SDC2_SDCC_HC_REG_4_6_ADDR A:0x67864904
y.create.l HWIO_SDC2_SDCC_HC_REG_8_A_ADDR A:0x67864908
y.create.l HWIO_SDC2_SDCC_HC_REG_C_E_ADDR A:0x6786490c
y.create.l HWIO_SDC2_SDCC_HC_REG_10_12_ADDR A:0x67864910
y.create.l HWIO_SDC2_SDCC_HC_REG_14_16_ADDR A:0x67864914
y.create.l HWIO_SDC2_SDCC_HC_REG_18_1A_ADDR A:0x67864918
y.create.l HWIO_SDC2_SDCC_HC_REG_1C_1E_ADDR A:0x6786491c
y.create.l HWIO_SDC2_SDCC_HC_REG_20_22_ADDR A:0x67864920
y.create.l HWIO_SDC2_SDCC_HC_REG_24_26_ADDR A:0x67864924
y.create.l HWIO_SDC2_SDCC_HC_REG_28_2A_ADDR A:0x67864928
y.create.l HWIO_SDC2_SDCC_HC_REG_2C_2E_ADDR A:0x6786492c
y.create.l HWIO_SDC2_SDCC_HC_REG_30_32_ADDR A:0x67864930
y.create.l HWIO_SDC2_SDCC_HC_REG_34_36_ADDR A:0x67864934
y.create.l HWIO_SDC2_SDCC_HC_REG_38_3A_ADDR A:0x67864938
y.create.l HWIO_SDC2_SDCC_HC_REG_3C_3E_ADDR A:0x6786493c
y.create.l HWIO_SDC2_SDCC_HC_REG_40_42_ADDR A:0x67864940
y.create.l HWIO_SDC2_SDCC_HC_REG_44_46_ADDR A:0x67864944
y.create.l HWIO_SDC2_SDCC_HC_REG_48_4A_ADDR A:0x67864948
y.create.l HWIO_SDC2_SDCC_HC_REG_50_52_ADDR A:0x67864950
y.create.l HWIO_SDC2_SDCC_HC_REG_54_56_ADDR A:0x67864954
y.create.l HWIO_SDC2_SDCC_HC_REG_58_5A_ADDR A:0x67864958
y.create.l HWIO_SDC2_SDCC_HC_REG_5C_5E_ADDR A:0x6786495c
y.create.l HWIO_SDC2_SDCC_HC_REG_60_62_ADDR A:0x67864960
y.create.l HWIO_SDC2_SDCC_HC_REG_64_66_ADDR A:0x67864964
y.create.l HWIO_SDC2_SDCC_HC_REG_68_6A_ADDR A:0x67864968
y.create.l HWIO_SDC2_SDCC_HC_REG_6C_6E_ADDR A:0x6786496c
y.create.l HWIO_SDC2_SDCC_HC_REG_E0_E2_ADDR A:0x678649e0
y.create.l HWIO_SDC2_SDCC_HC_REG_FC_FE_ADDR A:0x678649fc
y.create.l HWIO_SDC2_SDCC_HC_REG_DLL_CONFIG_ADDR A:0x67864a00
y.create.l HWIO_SDC2_SDCC_HC_REG_DLL_TEST_CTL_ADDR A:0x67864a04
y.create.l HWIO_SDC2_SDCC_HC_REG_DLL_STATUS_ADDR A:0x67864a08
y.create.l HWIO_SDC2_SDCC_HC_VENDOR_SPECIFIC_FUNC_ADDR A:0x67864a0c
y.create.l HWIO_SDC2_SDCC_HC_VENDOR_SPECIFIC_FUNC2_ADDR A:0x67864a10
y.create.l HWIO_SDC2_SDCC_HC_VENDOR_SPECIFIC_ADMA_ERR_ADDR0_ADDR A:0x67864a14
y.create.l HWIO_SDC2_SDCC_HC_VENDOR_SPECIFIC_ADMA_ERR_ADDR1_ADDR A:0x67864a18
y.create.l HWIO_SDC2_SDCC_HC_VENDOR_SPECIFIC_CAPABILITIES0_ADDR A:0x67864a1c
y.create.l HWIO_SDC2_SDCC_HC_VENDOR_SPECIFIC_CAPABILITIES1_ADDR A:0x67864a20
y.create.l HWIO_SDC2_SDCC_HC_VENDOR_SPECIFIC_T4_DLY_CTRL_ADDR A:0x67864a24
y.create.l HWIO_SDC2_SDCC_HC_VENDOR_SPECIFIC_T4_DLY_STAT_ADDR A:0x67864a28
y.create.l HWIO_SDC2_SDCC_HC_VENDOR_SPECIFIC_CSR_CDC_CTLR_CFG0_ADDR A:0x67864a30
y.create.l HWIO_SDC2_SDCC_HC_VENDOR_SPECIFIC_CSR_CDC_CTLR_CFG1_ADDR A:0x67864a34
y.create.l HWIO_SDC2_SDCC_HC_VENDOR_SPECIFIC_CSR_CDC_CAL_TIMER_CFG0_ADDR A:0x67864a38
y.create.l HWIO_SDC2_SDCC_HC_VENDOR_SPECIFIC_CSR_CDC_CAL_TIMER_CFG1_ADDR A:0x67864a3c
y.create.l HWIO_SDC2_SDCC_HC_VENDOR_SPECIFIC_CSR_CDC_REFCOUNT_CFG_ADDR A:0x67864a40
y.create.l HWIO_SDC2_SDCC_HC_VENDOR_SPECIFIC_CSR_CDC_COARSE_CAL_CFG_ADDR A:0x67864a44
y.create.l HWIO_SDC2_SDCC_HC_VENDOR_SPECIFIC_CSR_CDC_RSVD_CFG_ADDR A:0x67864a48
y.create.l HWIO_SDC2_SDCC_HC_VENDOR_SPECIFIC_CSR_CDC_OFFSET_CFG_ADDR A:0x67864a4c
y.create.l HWIO_SDC2_SDCC_HC_VENDOR_SPECIFIC_CSR_CDC_DELAY_CFG_ADDR A:0x67864a50
y.create.l HWIO_SDC2_SDCC_HC_VENDOR_SPECIFIC_CSR_CDC_SW_MODE_CFG_ADDR A:0x67864a54
y.create.l HWIO_SDC2_SDCC_HC_VENDOR_SPECIFIC_CSR_CDC_TEST_CFG_ADDR A:0x67864a58
y.create.l HWIO_SDC2_SDCC_HC_VENDOR_SPECIFIC_CSR_CDC_SW_OVRD_CFG_ADDR A:0x67864a5c
y.create.l HWIO_SDC2_SDCC_HC_VENDOR_SPECIFIC_CSR_CDC_SLAVE_DDA_CFG_ADDR A:0x67864a60
y.create.l HWIO_SDC2_SDCC_HC_VENDOR_SPECIFIC_CSR_CDC_STATUS0_ADDR A:0x67864a64
y.create.l HWIO_SDC2_SDCC_HC_VENDOR_SPECIFIC_CSR_CDC_STATUS1_ADDR A:0x67864a68
y.create.l HWIO_SDC2_SDCC_HC_VENDOR_SPECIFIC_CSR_CDC_STATUS2_ADDR A:0x67864a6c
y.create.l HWIO_SDC2_SDCC_HC_VENDOR_SPECIFIC_CSR_CDC_STATUS3_ADDR A:0x67864a70
y.create.l HWIO_SDC2_SDCC_HC_VENDOR_SPECIFIC_CSR_CDC_STATUS4_ADDR A:0x67864a74
y.create.l HWIO_SDC2_SDCC_HC_VENDOR_SPECIFIC_CSR_CDC_GEN_CFG_ADDR A:0x67864a78
y.create.l HWIO_SDC2_SDCC_HC_VENDOR_SPECIFIC_CDC_AUTO_SW_CAL_CFG_ADDR A:0x67864a7c
y.create.l HWIO_SDC2_SDCC_HC_VENDOR_SPECIFIC_DDR200_STAT_ADDR A:0x67864a80
y.create.l HWIO_SDC2_SDCC_HC_VENDOR_SPECIFIC_DDR200_CFG_ADDR A:0x67864a84
y.create.l HWIO_SDC2_SDCC_HC_VENDOR_SPECIFIC_TIME_COUNT_CTRL_ADDR A:0x67864a88
y.create.l HWIO_SDC2_SDCC_HC_VENDOR_SPECIFIC_FLOW_CTRL_TIME_COUNT_ADDR A:0x67864a8c
y.create.l HWIO_SDC2_SDCC_HC_VENDOR_SPECIFIC_BUSY_TIME_COUNT_ADDR A:0x67864a90
y.create.l HWIO_SDC2_SDCC_HC_VENDOR_SPECIFIC_DATA_TIME_COUNT_ADDR A:0x67864a94
y.create.l HWIO_SDC2_SDCC_HC_VENDOR_SPECIFIC_CMD_TIME_COUNT_ADDR A:0x67864a98
y.create.l HWIO_SDC2_SDCC_HC_VENDOR_SPECIFIC_ERR_INT_STS_ADDR A:0x67864a9c
y.create.l HWIO_SDC2_SDCC_HC_VENDOR_SPECIFIC_PWRCTL_STATUS_REG_ADDR A:0x67864aa0
y.create.l HWIO_SDC2_SDCC_HC_VENDOR_SPECIFIC_PWRCTL_MASK_REG_ADDR A:0x67864aa4
y.create.l HWIO_SDC2_SDCC_HC_VENDOR_SPECIFIC_PWRCTL_CLEAR_REG_ADDR A:0x67864aa8
y.create.l HWIO_SDC2_SDCC_HC_VENDOR_SPECIFIC_PWRCTL_CTL_REG_ADDR A:0x67864aac
y.create.l HWIO_SDC2_SDCC_HC_VENDOR_SPECIFIC_FUNC3_ADDR A:0x67864ab0
y.create.l HWIO_SDC2_SDCC_HC_REG_DLL_CONFIG_2_ADDR A:0x67864ab4
y.create.l HWIO_SDC2_SDCC_HC_REG_DDR_CONFIG_ADDR A:0x67864ab8
y.create.l HWIO_QFPROM_RAW_JTAG_ID_ADDR A:0x60058000
y.create.l HWIO_QFPROM_RAW_PTE1_ADDR A:0x60058004
y.create.l HWIO_QFPROM_RAW_SERIAL_NUM_ADDR A:0x60058008
y.create.l HWIO_QFPROM_RAW_PTE2_ADDR A:0x6005800c
y.create.l HWIO_QFPROM_RAW_RD_WR_PERM_LSB_ADDR A:0x60058010
y.create.l HWIO_QFPROM_RAW_RD_WR_PERM_MSB_ADDR A:0x60058014
y.create.l HWIO_QFPROM_RAW_ANTI_ROLLBACK_1_LSB_ADDR A:0x60058018
y.create.l HWIO_QFPROM_RAW_ANTI_ROLLBACK_1_MSB_ADDR A:0x6005801c
y.create.l HWIO_QFPROM_RAW_ANTI_ROLLBACK_2_LSB_ADDR A:0x60058020
y.create.l HWIO_QFPROM_RAW_ANTI_ROLLBACK_2_MSB_ADDR A:0x60058024
y.create.l HWIO_QFPROM_RAW_ANTI_ROLLBACK_3_LSB_ADDR A:0x60058028
y.create.l HWIO_QFPROM_RAW_ANTI_ROLLBACK_3_MSB_ADDR A:0x6005802c
y.create.l HWIO_QFPROM_RAW_OEM_CONFIG_ROW0_LSB_ADDR A:0x60058030
y.create.l HWIO_QFPROM_RAW_OEM_CONFIG_ROW0_MSB_ADDR A:0x60058034
y.create.l HWIO_QFPROM_RAW_OEM_CONFIG_ROW1_LSB_ADDR A:0x60058038
y.create.l HWIO_QFPROM_RAW_OEM_CONFIG_ROW1_MSB_ADDR A:0x6005803c
y.create.l HWIO_QFPROM_RAW_FEAT_CONFIG_ROW0_LSB_ADDR A:0x60058040
y.create.l HWIO_QFPROM_RAW_FEAT_CONFIG_ROW0_MSB_ADDR A:0x60058044
y.create.l HWIO_QFPROM_RAW_FEAT_CONFIG_ROW1_LSB_ADDR A:0x60058048
y.create.l HWIO_QFPROM_RAW_FEAT_CONFIG_ROW1_MSB_ADDR A:0x6005804c
y.create.l HWIO_QFPROM_RAW_FEAT_CONFIG_ROW2_LSB_ADDR A:0x60058050
y.create.l HWIO_QFPROM_RAW_FEAT_CONFIG_ROW2_MSB_ADDR A:0x60058054
y.create.l HWIO_QFPROM_RAW_PRI_KEY_DERIVATION_KEY_ROW0_LSB_ADDR A:0x60058058
y.create.l HWIO_QFPROM_RAW_PRI_KEY_DERIVATION_KEY_ROW1_LSB_ADDR A:0x60058060
y.create.l HWIO_QFPROM_RAW_PRI_KEY_DERIVATION_KEY_ROW2_LSB_ADDR A:0x60058068
y.create.l HWIO_QFPROM_RAW_PRI_KEY_DERIVATION_KEY_ROW3_LSB_ADDR A:0x60058070
y.create.l HWIO_QFPROM_RAW_PRI_KEY_DERIVATION_KEY_ROW0_MSB_ADDR A:0x6005805c
y.create.l HWIO_QFPROM_RAW_PRI_KEY_DERIVATION_KEY_ROW1_MSB_ADDR A:0x60058064
y.create.l HWIO_QFPROM_RAW_PRI_KEY_DERIVATION_KEY_ROW2_MSB_ADDR A:0x6005806c
y.create.l HWIO_QFPROM_RAW_PRI_KEY_DERIVATION_KEY_ROW3_MSB_ADDR A:0x60058074
y.create.l HWIO_QFPROM_RAW_SEC_KEY_DERIVATION_KEY_ROW0_LSB_ADDR A:0x60058078
y.create.l HWIO_QFPROM_RAW_SEC_KEY_DERIVATION_KEY_ROW1_LSB_ADDR A:0x60058080
y.create.l HWIO_QFPROM_RAW_SEC_KEY_DERIVATION_KEY_ROW2_LSB_ADDR A:0x60058088
y.create.l HWIO_QFPROM_RAW_SEC_KEY_DERIVATION_KEY_ROW3_LSB_ADDR A:0x60058090
y.create.l HWIO_QFPROM_RAW_SEC_KEY_DERIVATION_KEY_ROW0_MSB_ADDR A:0x6005807c
y.create.l HWIO_QFPROM_RAW_SEC_KEY_DERIVATION_KEY_ROW1_MSB_ADDR A:0x60058084
y.create.l HWIO_QFPROM_RAW_SEC_KEY_DERIVATION_KEY_ROW2_MSB_ADDR A:0x6005808c
y.create.l HWIO_QFPROM_RAW_SEC_KEY_DERIVATION_KEY_ROW3_MSB_ADDR A:0x60058094
y.create.l HWIO_QFPROM_RAW_OEM_SEC_BOOT_ROW0_LSB_ADDR A:0x60058098
y.create.l HWIO_QFPROM_RAW_OEM_SEC_BOOT_ROW0_MSB_ADDR A:0x6005809c
y.create.l HWIO_QFPROM_RAW_CALIB2_ROW0_LSB_ADDR A:0x600580a0
y.create.l HWIO_QFPROM_RAW_CALIB2_ROW0_MSB_ADDR A:0x600580a4
y.create.l HWIO_QFPROM_RAW_PK_HASH_ROW0_LSB_ADDR A:0x600580a8
y.create.l HWIO_QFPROM_RAW_PK_HASH_ROW1_LSB_ADDR A:0x600580b0
y.create.l HWIO_QFPROM_RAW_PK_HASH_ROW2_LSB_ADDR A:0x600580b8
y.create.l HWIO_QFPROM_RAW_PK_HASH_ROW3_LSB_ADDR A:0x600580c0
y.create.l HWIO_QFPROM_RAW_PK_HASH_ROW0_MSB_ADDR A:0x600580ac
y.create.l HWIO_QFPROM_RAW_PK_HASH_ROW1_MSB_ADDR A:0x600580b4
y.create.l HWIO_QFPROM_RAW_PK_HASH_ROW2_MSB_ADDR A:0x600580bc
y.create.l HWIO_QFPROM_RAW_PK_HASH_ROW3_MSB_ADDR A:0x600580c4
y.create.l HWIO_QFPROM_RAW_PK_HASH_ROW4_LSB_ADDR A:0x600580c8
y.create.l HWIO_QFPROM_RAW_PK_HASH_ROW4_MSB_ADDR A:0x600580cc
y.create.l HWIO_QFPROM_RAW_CALIB_ROW0_LSB_ADDR A:0x600580d0
y.create.l HWIO_QFPROM_RAW_CALIB_ROW0_MSB_ADDR A:0x600580d4
y.create.l HWIO_QFPROM_RAW_CALIB_ROW1_LSB_ADDR A:0x600580d8
y.create.l HWIO_QFPROM_RAW_CALIB_ROW1_MSB_ADDR A:0x600580dc
y.create.l HWIO_QFPROM_RAW_CALIB_ROW2_LSB_ADDR A:0x600580e0
y.create.l HWIO_QFPROM_RAW_CALIB_ROW2_MSB_ADDR A:0x600580e4
y.create.l HWIO_QFPROM_RAW_CALIB_ROW3_LSB_ADDR A:0x600580e8
y.create.l HWIO_QFPROM_RAW_CALIB_ROW3_MSB_ADDR A:0x600580ec
y.create.l HWIO_QFPROM_RAW_MEM_CONFIG_ROW0_LSB_ADDR A:0x600580f0
y.create.l HWIO_QFPROM_RAW_MEM_CONFIG_ROW1_LSB_ADDR A:0x600580f8
y.create.l HWIO_QFPROM_RAW_MEM_CONFIG_ROW2_LSB_ADDR A:0x60058100
y.create.l HWIO_QFPROM_RAW_MEM_CONFIG_ROW3_LSB_ADDR A:0x60058108
y.create.l HWIO_QFPROM_RAW_MEM_CONFIG_ROW0_MSB_ADDR A:0x600580f4
y.create.l HWIO_QFPROM_RAW_MEM_CONFIG_ROW1_MSB_ADDR A:0x600580fc
y.create.l HWIO_QFPROM_RAW_MEM_CONFIG_ROW2_MSB_ADDR A:0x60058104
y.create.l HWIO_QFPROM_RAW_MEM_CONFIG_ROW3_MSB_ADDR A:0x6005810c
y.create.l HWIO_QFPROM_RAW_MEM_CONFIG_ROW4_LSB_ADDR A:0x60058110
y.create.l HWIO_QFPROM_RAW_MEM_CONFIG_ROW4_MSB_ADDR A:0x60058114
y.create.l HWIO_QFPROM_RAW_ROM_PATCH_ADDR_ROW0_LSB_ADDR A:0x60058118
y.create.l HWIO_QFPROM_RAW_ROM_PATCH_ADDR_ROW1_LSB_ADDR A:0x60058120
y.create.l HWIO_QFPROM_RAW_ROM_PATCH_ADDR_ROW2_LSB_ADDR A:0x60058128
y.create.l HWIO_QFPROM_RAW_ROM_PATCH_ADDR_ROW3_LSB_ADDR A:0x60058130
y.create.l HWIO_QFPROM_RAW_ROM_PATCH_ADDR_ROW4_LSB_ADDR A:0x60058138
y.create.l HWIO_QFPROM_RAW_ROM_PATCH_ADDR_ROW5_LSB_ADDR A:0x60058140
y.create.l HWIO_QFPROM_RAW_ROM_PATCH_ADDR_ROW6_LSB_ADDR A:0x60058148
y.create.l HWIO_QFPROM_RAW_ROM_PATCH_ADDR_ROW0_MSB_ADDR A:0x6005811c
y.create.l HWIO_QFPROM_RAW_ROM_PATCH_ADDR_ROW1_MSB_ADDR A:0x60058124
y.create.l HWIO_QFPROM_RAW_ROM_PATCH_ADDR_ROW2_MSB_ADDR A:0x6005812c
y.create.l HWIO_QFPROM_RAW_ROM_PATCH_ADDR_ROW3_MSB_ADDR A:0x60058134
y.create.l HWIO_QFPROM_RAW_ROM_PATCH_ADDR_ROW4_MSB_ADDR A:0x6005813c
y.create.l HWIO_QFPROM_RAW_ROM_PATCH_ADDR_ROW5_MSB_ADDR A:0x60058144
y.create.l HWIO_QFPROM_RAW_ROM_PATCH_ADDR_ROW6_MSB_ADDR A:0x6005814c
y.create.l HWIO_QFPROM_RAW_ROM_PATCH_ADDR_ROW7_LSB_ADDR A:0x60058150
y.create.l HWIO_QFPROM_RAW_ROM_PATCH_ADDR_ROW7_MSB_ADDR A:0x60058154
y.create.l HWIO_QFPROM_RAW_ROM_PATCH_DATA_ROW0_LSB_ADDR A:0x60058158
y.create.l HWIO_QFPROM_RAW_ROM_PATCH_DATA_ROW1_LSB_ADDR A:0x60058160
y.create.l HWIO_QFPROM_RAW_ROM_PATCH_DATA_ROW2_LSB_ADDR A:0x60058168
y.create.l HWIO_QFPROM_RAW_ROM_PATCH_DATA_ROW3_LSB_ADDR A:0x60058170
y.create.l HWIO_QFPROM_RAW_ROM_PATCH_DATA_ROW4_LSB_ADDR A:0x60058178
y.create.l HWIO_QFPROM_RAW_ROM_PATCH_DATA_ROW5_LSB_ADDR A:0x60058180
y.create.l HWIO_QFPROM_RAW_ROM_PATCH_DATA_ROW6_LSB_ADDR A:0x60058188
y.create.l HWIO_QFPROM_RAW_ROM_PATCH_DATA_ROW7_LSB_ADDR A:0x60058190
y.create.l HWIO_QFPROM_RAW_ROM_PATCH_DATA_ROW8_LSB_ADDR A:0x60058198
y.create.l HWIO_QFPROM_RAW_ROM_PATCH_DATA_ROW9_LSB_ADDR A:0x600581a0
y.create.l HWIO_QFPROM_RAW_ROM_PATCH_DATA_ROW0_MSB_ADDR A:0x6005815c
y.create.l HWIO_QFPROM_RAW_ROM_PATCH_DATA_ROW1_MSB_ADDR A:0x60058164
y.create.l HWIO_QFPROM_RAW_ROM_PATCH_DATA_ROW2_MSB_ADDR A:0x6005816c
y.create.l HWIO_QFPROM_RAW_ROM_PATCH_DATA_ROW3_MSB_ADDR A:0x60058174
y.create.l HWIO_QFPROM_RAW_ROM_PATCH_DATA_ROW4_MSB_ADDR A:0x6005817c
y.create.l HWIO_QFPROM_RAW_ROM_PATCH_DATA_ROW5_MSB_ADDR A:0x60058184
y.create.l HWIO_QFPROM_RAW_ROM_PATCH_DATA_ROW6_MSB_ADDR A:0x6005818c
y.create.l HWIO_QFPROM_RAW_ROM_PATCH_DATA_ROW7_MSB_ADDR A:0x60058194
y.create.l HWIO_QFPROM_RAW_ROM_PATCH_DATA_ROW8_MSB_ADDR A:0x6005819c
y.create.l HWIO_QFPROM_RAW_ROM_PATCH_DATA_ROW9_MSB_ADDR A:0x600581a4
y.create.l HWIO_QFPROM_RAW_ROM_PATCH_EN_LSB_ADDR A:0x600581d0
y.create.l HWIO_QFPROM_RAW_ROM_PATCH_EN_MSB_ADDR A:0x600581d4
y.create.l HWIO_QFPROM_RAW_SPARE_REG15_LSB_ADDR A:0x600581d8
y.create.l HWIO_QFPROM_RAW_SPARE_REG15_MSB_ADDR A:0x600581dc
y.create.l HWIO_QFPROM_RAW_SPARE_REG16_LSB_ADDR A:0x600581e0
y.create.l HWIO_QFPROM_RAW_SPARE_REG16_MSB_ADDR A:0x600581e4
y.create.l HWIO_QFPROM_RAW_SPARE_REG17_LSB_ADDR A:0x600581e8
y.create.l HWIO_QFPROM_RAW_SPARE_REG17_MSB_ADDR A:0x600581ec
y.create.l HWIO_QFPROM_RAW_SPARE_REG18_LSB_ADDR A:0x600581f0
y.create.l HWIO_QFPROM_RAW_SPARE_REG18_MSB_ADDR A:0x600581f4
y.create.l HWIO_QFPROM_RAW_SPARE_REG19_LSB_ADDR A:0x600581f8
y.create.l HWIO_QFPROM_RAW_SPARE_REG19_MSB_ADDR A:0x600581fc
y.create.l HWIO_QFPROM_RAW_ACC_PRIVATE0_ADDR A:0x60058200
y.create.l HWIO_QFPROM_RAW_ACC_PRIVATE1_ADDR A:0x60058204
y.create.l HWIO_QFPROM_RAW_ACC_PRIVATE2_ADDR A:0x60058208
y.create.l HWIO_QFPROM_RAW_ACC_PRIVATE3_ADDR A:0x6005820c
y.create.l HWIO_QFPROM_RAW_ACC_PRIVATE4_ADDR A:0x60058210
y.create.l HWIO_QFPROM_RAW_ACC_PRIVATE5_ADDR A:0x60058214
y.create.l HWIO_QFPROM_RAW_ACC_PRIVATE6_ADDR A:0x60058218
y.create.l HWIO_QFPROM_RAW_ACC_PRIVATE7_ADDR A:0x6005821c
y.create.l HWIO_QFPROM_RAW_ACC_PRIVATE8_ADDR A:0x60058220
y.create.l HWIO_QFPROM_RAW_ACC_PRIVATE9_ADDR A:0x60058224
y.create.l HWIO_ACC_IR_ADDR A:0x6005a000
y.create.l HWIO_ACC_DR_ADDR A:0x6005a004
y.create.l HWIO_ACC_VERID_ADDR A:0x6005a008
y.create.l HWIO_ACC_FEATSET0_ADDR A:0x6005a010
y.create.l HWIO_ACC_FEATSET1_ADDR A:0x6005a014
y.create.l HWIO_ACC_FEATSET2_ADDR A:0x6005a018
y.create.l HWIO_ACC_FEATSET3_ADDR A:0x6005a01c
y.create.l HWIO_ACC_FEATSET4_ADDR A:0x6005a020
y.create.l HWIO_ACC_FEATSET5_ADDR A:0x6005a024
y.create.l HWIO_ACC_FEATSET6_ADDR A:0x6005a028
y.create.l HWIO_ACC_FEATSET7_ADDR A:0x6005a02c
y.create.l HWIO_ACC_STATE_ADDR A:0x6005a038
y.create.l HWIO_QFPROM_BLOW_TIMER_ADDR A:0x6005a03c
y.create.l HWIO_QFPROM_TEST_CTRL_ADDR A:0x6005a040
y.create.l HWIO_QFPROM_ACCEL_ADDR A:0x6005a044
y.create.l HWIO_QFPROM_BLOW_STATUS_ADDR A:0x6005a048
y.create.l HWIO_QFPROM_ROM_ERROR_ADDR A:0x6005a04c
y.create.l HWIO_QFPROM_BIST_CTRL_ADDR A:0x6005a050
y.create.l HWIO_QFPROM_BIST_ERROR_ADDR A:0x6005a054
y.create.l HWIO_QFPROM_HASH_SIGNATURE0_ADDR A:0x6005a060
y.create.l HWIO_QFPROM_HASH_SIGNATURE1_ADDR A:0x6005a064
y.create.l HWIO_QFPROM_HASH_SIGNATURE2_ADDR A:0x6005a068
y.create.l HWIO_QFPROM_HASH_SIGNATURE3_ADDR A:0x6005a06c
y.create.l HWIO_QFPROM_HASH_SIGNATURE4_ADDR A:0x6005a070
y.create.l HWIO_QFPROM_HASH_SIGNATURE5_ADDR A:0x6005a074
y.create.l HWIO_QFPROM_HASH_SIGNATURE6_ADDR A:0x6005a078
y.create.l HWIO_QFPROM_HASH_SIGNATURE7_ADDR A:0x6005a07c
y.create.l HWIO_HW_KEY_STATUS_ADDR A:0x6005a080
y.create.l HWIO_RESET_JDR_STATUS_ADDR A:0x6005a084
y.create.l HWIO_FEC_ESR_ADDR A:0x6005a090
y.create.l HWIO_FEC_EAR_ADDR A:0x6005a094
y.create.l HWIO_QFPROM_CORR_JTAG_ID_ADDR A:0x6005c000
y.create.l HWIO_QFPROM_CORR_PTE1_ADDR A:0x6005c004
y.create.l HWIO_QFPROM_CORR_SERIAL_NUM_ADDR A:0x6005c008
y.create.l HWIO_QFPROM_CORR_PTE2_ADDR A:0x6005c00c
y.create.l HWIO_QFPROM_CORR_RD_WR_PERM_LSB_ADDR A:0x6005c010
y.create.l HWIO_QFPROM_CORR_RD_WR_PERM_MSB_ADDR A:0x6005c014
y.create.l HWIO_QFPROM_CORR_ANTI_ROLLBACK_1_LSB_ADDR A:0x6005c018
y.create.l HWIO_QFPROM_CORR_ANTI_ROLLBACK_1_MSB_ADDR A:0x6005c01c
y.create.l HWIO_QFPROM_CORR_ANTI_ROLLBACK_2_LSB_ADDR A:0x6005c020
y.create.l HWIO_QFPROM_CORR_ANTI_ROLLBACK_2_MSB_ADDR A:0x6005c024
y.create.l HWIO_QFPROM_CORR_ANTI_ROLLBACK_3_LSB_ADDR A:0x6005c028
y.create.l HWIO_QFPROM_CORR_ANTI_ROLLBACK_3_MSB_ADDR A:0x6005c02c
y.create.l HWIO_QFPROM_CORR_OEM_CONFIG_ROW0_LSB_ADDR A:0x6005c030
y.create.l HWIO_QFPROM_CORR_OEM_CONFIG_ROW0_MSB_ADDR A:0x6005c034
y.create.l HWIO_QFPROM_CORR_OEM_CONFIG_ROW1_LSB_ADDR A:0x6005c038
y.create.l HWIO_QFPROM_CORR_OEM_CONFIG_ROW1_MSB_ADDR A:0x6005c03c
y.create.l HWIO_QFPROM_CORR_FEAT_CONFIG_ROW0_LSB_ADDR A:0x6005c040
y.create.l HWIO_QFPROM_CORR_FEAT_CONFIG_ROW0_MSB_ADDR A:0x6005c044
y.create.l HWIO_QFPROM_CORR_FEAT_CONFIG_ROW1_LSB_ADDR A:0x6005c048
y.create.l HWIO_QFPROM_CORR_FEAT_CONFIG_ROW1_MSB_ADDR A:0x6005c04c
y.create.l HWIO_QFPROM_CORR_FEAT_CONFIG_ROW2_LSB_ADDR A:0x6005c050
y.create.l HWIO_QFPROM_CORR_FEAT_CONFIG_ROW2_MSB_ADDR A:0x6005c054
y.create.l HWIO_QFPROM_CORR_PRI_KEY_DERIVATION_KEY_ROW0_LSB_ADDR A:0x6005c058
y.create.l HWIO_QFPROM_CORR_PRI_KEY_DERIVATION_KEY_ROW1_LSB_ADDR A:0x6005c060
y.create.l HWIO_QFPROM_CORR_PRI_KEY_DERIVATION_KEY_ROW2_LSB_ADDR A:0x6005c068
y.create.l HWIO_QFPROM_CORR_PRI_KEY_DERIVATION_KEY_ROW3_LSB_ADDR A:0x6005c070
y.create.l HWIO_QFPROM_CORR_PRI_KEY_DERIVATION_KEY_ROW0_MSB_ADDR A:0x6005c05c
y.create.l HWIO_QFPROM_CORR_PRI_KEY_DERIVATION_KEY_ROW1_MSB_ADDR A:0x6005c064
y.create.l HWIO_QFPROM_CORR_PRI_KEY_DERIVATION_KEY_ROW2_MSB_ADDR A:0x6005c06c
y.create.l HWIO_QFPROM_CORR_PRI_KEY_DERIVATION_KEY_ROW3_MSB_ADDR A:0x6005c074
y.create.l HWIO_QFPROM_CORR_SEC_KEY_DERIVATION_KEY_ROW0_LSB_ADDR A:0x6005c078
y.create.l HWIO_QFPROM_CORR_SEC_KEY_DERIVATION_KEY_ROW1_LSB_ADDR A:0x6005c080
y.create.l HWIO_QFPROM_CORR_SEC_KEY_DERIVATION_KEY_ROW2_LSB_ADDR A:0x6005c088
y.create.l HWIO_QFPROM_CORR_SEC_KEY_DERIVATION_KEY_ROW3_LSB_ADDR A:0x6005c090
y.create.l HWIO_QFPROM_CORR_SEC_KEY_DERIVATION_KEY_ROW0_MSB_ADDR A:0x6005c07c
y.create.l HWIO_QFPROM_CORR_SEC_KEY_DERIVATION_KEY_ROW1_MSB_ADDR A:0x6005c084
y.create.l HWIO_QFPROM_CORR_SEC_KEY_DERIVATION_KEY_ROW2_MSB_ADDR A:0x6005c08c
y.create.l HWIO_QFPROM_CORR_SEC_KEY_DERIVATION_KEY_ROW3_MSB_ADDR A:0x6005c094
y.create.l HWIO_QFPROM_CORR_OEM_SEC_BOOT_ROW0_LSB_ADDR A:0x6005c098
y.create.l HWIO_QFPROM_CORR_OEM_SEC_BOOT_ROW0_MSB_ADDR A:0x6005c09c
y.create.l HWIO_QFPROM_CORR_CALIB2_ROW0_LSB_ADDR A:0x6005c0a0
y.create.l HWIO_QFPROM_CORR_CALIB2_ROW0_MSB_ADDR A:0x6005c0a4
y.create.l HWIO_QFPROM_CORR_PK_HASH_ROW0_LSB_ADDR A:0x6005c0a8
y.create.l HWIO_QFPROM_CORR_PK_HASH_ROW1_LSB_ADDR A:0x6005c0b0
y.create.l HWIO_QFPROM_CORR_PK_HASH_ROW2_LSB_ADDR A:0x6005c0b8
y.create.l HWIO_QFPROM_CORR_PK_HASH_ROW3_LSB_ADDR A:0x6005c0c0
y.create.l HWIO_QFPROM_CORR_PK_HASH_ROW0_MSB_ADDR A:0x6005c0ac
y.create.l HWIO_QFPROM_CORR_PK_HASH_ROW1_MSB_ADDR A:0x6005c0b4
y.create.l HWIO_QFPROM_CORR_PK_HASH_ROW2_MSB_ADDR A:0x6005c0bc
y.create.l HWIO_QFPROM_CORR_PK_HASH_ROW3_MSB_ADDR A:0x6005c0c4
y.create.l HWIO_QFPROM_CORR_PK_HASH_ROW4_LSB_ADDR A:0x6005c0c8
y.create.l HWIO_QFPROM_CORR_PK_HASH_ROW4_MSB_ADDR A:0x6005c0cc
y.create.l HWIO_QFPROM_CORR_CALIB_ROW0_LSB_ADDR A:0x6005c0d0
y.create.l HWIO_QFPROM_CORR_CALIB_ROW0_MSB_ADDR A:0x6005c0d4
y.create.l HWIO_QFPROM_CORR_CALIB_ROW1_LSB_ADDR A:0x6005c0d8
y.create.l HWIO_QFPROM_CORR_CALIB_ROW1_MSB_ADDR A:0x6005c0dc
y.create.l HWIO_QFPROM_CORR_CALIB_ROW2_LSB_ADDR A:0x6005c0e0
y.create.l HWIO_QFPROM_CORR_CALIB_ROW2_MSB_ADDR A:0x6005c0e4
y.create.l HWIO_QFPROM_CORR_CALIB_ROW3_LSB_ADDR A:0x6005c0e8
y.create.l HWIO_QFPROM_CORR_CALIB_ROW3_MSB_ADDR A:0x6005c0ec
y.create.l HWIO_QFPROM_CORR_MEM_CONFIG_ROW0_LSB_ADDR A:0x6005c0f0
y.create.l HWIO_QFPROM_CORR_MEM_CONFIG_ROW1_LSB_ADDR A:0x6005c0f8
y.create.l HWIO_QFPROM_CORR_MEM_CONFIG_ROW2_LSB_ADDR A:0x6005c100
y.create.l HWIO_QFPROM_CORR_MEM_CONFIG_ROW3_LSB_ADDR A:0x6005c108
y.create.l HWIO_QFPROM_CORR_MEM_CONFIG_ROW0_MSB_ADDR A:0x6005c0f4
y.create.l HWIO_QFPROM_CORR_MEM_CONFIG_ROW1_MSB_ADDR A:0x6005c0fc
y.create.l HWIO_QFPROM_CORR_MEM_CONFIG_ROW2_MSB_ADDR A:0x6005c104
y.create.l HWIO_QFPROM_CORR_MEM_CONFIG_ROW3_MSB_ADDR A:0x6005c10c
y.create.l HWIO_QFPROM_CORR_MEM_CONFIG_ROW4_LSB_ADDR A:0x6005c110
y.create.l HWIO_QFPROM_CORR_MEM_CONFIG_ROW4_MSB_ADDR A:0x6005c114
y.create.l HWIO_QFPROM_CORR_ROM_PATCH_ADDR_ROW0_LSB_ADDR A:0x6005c118
y.create.l HWIO_QFPROM_CORR_ROM_PATCH_ADDR_ROW1_LSB_ADDR A:0x6005c120
y.create.l HWIO_QFPROM_CORR_ROM_PATCH_ADDR_ROW2_LSB_ADDR A:0x6005c128
y.create.l HWIO_QFPROM_CORR_ROM_PATCH_ADDR_ROW3_LSB_ADDR A:0x6005c130
y.create.l HWIO_QFPROM_CORR_ROM_PATCH_ADDR_ROW4_LSB_ADDR A:0x6005c138
y.create.l HWIO_QFPROM_CORR_ROM_PATCH_ADDR_ROW5_LSB_ADDR A:0x6005c140
y.create.l HWIO_QFPROM_CORR_ROM_PATCH_ADDR_ROW6_LSB_ADDR A:0x6005c148
y.create.l HWIO_QFPROM_CORR_ROM_PATCH_ADDR_ROW0_MSB_ADDR A:0x6005c11c
y.create.l HWIO_QFPROM_CORR_ROM_PATCH_ADDR_ROW1_MSB_ADDR A:0x6005c124
y.create.l HWIO_QFPROM_CORR_ROM_PATCH_ADDR_ROW2_MSB_ADDR A:0x6005c12c
y.create.l HWIO_QFPROM_CORR_ROM_PATCH_ADDR_ROW3_MSB_ADDR A:0x6005c134
y.create.l HWIO_QFPROM_CORR_ROM_PATCH_ADDR_ROW4_MSB_ADDR A:0x6005c13c
y.create.l HWIO_QFPROM_CORR_ROM_PATCH_ADDR_ROW5_MSB_ADDR A:0x6005c144
y.create.l HWIO_QFPROM_CORR_ROM_PATCH_ADDR_ROW6_MSB_ADDR A:0x6005c14c
y.create.l HWIO_QFPROM_CORR_ROM_PATCH_ADDR_ROW7_LSB_ADDR A:0x6005c150
y.create.l HWIO_QFPROM_CORR_ROM_PATCH_ADDR_ROW7_MSB_ADDR A:0x6005c154
y.create.l HWIO_QFPROM_CORR_ROM_PATCH_DATA_ROW0_LSB_ADDR A:0x6005c158
y.create.l HWIO_QFPROM_CORR_ROM_PATCH_DATA_ROW1_LSB_ADDR A:0x6005c160
y.create.l HWIO_QFPROM_CORR_ROM_PATCH_DATA_ROW2_LSB_ADDR A:0x6005c168
y.create.l HWIO_QFPROM_CORR_ROM_PATCH_DATA_ROW3_LSB_ADDR A:0x6005c170
y.create.l HWIO_QFPROM_CORR_ROM_PATCH_DATA_ROW4_LSB_ADDR A:0x6005c178
y.create.l HWIO_QFPROM_CORR_ROM_PATCH_DATA_ROW5_LSB_ADDR A:0x6005c180
y.create.l HWIO_QFPROM_CORR_ROM_PATCH_DATA_ROW6_LSB_ADDR A:0x6005c188
y.create.l HWIO_QFPROM_CORR_ROM_PATCH_DATA_ROW7_LSB_ADDR A:0x6005c190
y.create.l HWIO_QFPROM_CORR_ROM_PATCH_DATA_ROW8_LSB_ADDR A:0x6005c198
y.create.l HWIO_QFPROM_CORR_ROM_PATCH_DATA_ROW9_LSB_ADDR A:0x6005c1a0
y.create.l HWIO_QFPROM_CORR_ROM_PATCH_DATA_ROW0_MSB_ADDR A:0x6005c15c
y.create.l HWIO_QFPROM_CORR_ROM_PATCH_DATA_ROW1_MSB_ADDR A:0x6005c164
y.create.l HWIO_QFPROM_CORR_ROM_PATCH_DATA_ROW2_MSB_ADDR A:0x6005c16c
y.create.l HWIO_QFPROM_CORR_ROM_PATCH_DATA_ROW3_MSB_ADDR A:0x6005c174
y.create.l HWIO_QFPROM_CORR_ROM_PATCH_DATA_ROW4_MSB_ADDR A:0x6005c17c
y.create.l HWIO_QFPROM_CORR_ROM_PATCH_DATA_ROW5_MSB_ADDR A:0x6005c184
y.create.l HWIO_QFPROM_CORR_ROM_PATCH_DATA_ROW6_MSB_ADDR A:0x6005c18c
y.create.l HWIO_QFPROM_CORR_ROM_PATCH_DATA_ROW7_MSB_ADDR A:0x6005c194
y.create.l HWIO_QFPROM_CORR_ROM_PATCH_DATA_ROW8_MSB_ADDR A:0x6005c19c
y.create.l HWIO_QFPROM_CORR_ROM_PATCH_DATA_ROW9_MSB_ADDR A:0x6005c1a4
y.create.l HWIO_QFPROM_CORR_ROM_PATCH_EN_LSB_ADDR A:0x6005c1d0
y.create.l HWIO_QFPROM_CORR_ROM_PATCH_EN_MSB_ADDR A:0x6005c1d4
y.create.l HWIO_QFPROM_CORR_SPARE_REG15_LSB_ADDR A:0x6005c1d8
y.create.l HWIO_QFPROM_CORR_SPARE_REG15_MSB_ADDR A:0x6005c1dc
y.create.l HWIO_QFPROM_CORR_SPARE_REG16_LSB_ADDR A:0x6005c1e0
y.create.l HWIO_QFPROM_CORR_SPARE_REG16_MSB_ADDR A:0x6005c1e4
y.create.l HWIO_QFPROM_CORR_SPARE_REG17_LSB_ADDR A:0x6005c1e8
y.create.l HWIO_QFPROM_CORR_SPARE_REG17_MSB_ADDR A:0x6005c1ec
y.create.l HWIO_QFPROM_CORR_SPARE_REG18_LSB_ADDR A:0x6005c1f0
y.create.l HWIO_QFPROM_CORR_SPARE_REG18_MSB_ADDR A:0x6005c1f4
y.create.l HWIO_QFPROM_CORR_SPARE_REG19_LSB_ADDR A:0x6005c1f8
y.create.l HWIO_QFPROM_CORR_SPARE_REG19_MSB_ADDR A:0x6005c1fc
y.create.l HWIO_QFPROM_CORR_ACC_PRIVATE0_ADDR A:0x6005c200
y.create.l HWIO_QFPROM_CORR_ACC_PRIVATE1_ADDR A:0x6005c204
y.create.l HWIO_QFPROM_CORR_ACC_PRIVATE2_ADDR A:0x6005c208
y.create.l HWIO_QFPROM_CORR_ACC_PRIVATE3_ADDR A:0x6005c20c
y.create.l HWIO_QFPROM_CORR_ACC_PRIVATE4_ADDR A:0x6005c210
y.create.l HWIO_QFPROM_CORR_ACC_PRIVATE5_ADDR A:0x6005c214
y.create.l HWIO_QFPROM_CORR_ACC_PRIVATE6_ADDR A:0x6005c218
y.create.l HWIO_QFPROM_CORR_ACC_PRIVATE7_ADDR A:0x6005c21c
y.create.l HWIO_QFPROM_CORR_ACC_PRIVATE8_ADDR A:0x6005c220
y.create.l HWIO_QFPROM_CORR_ACC_PRIVATE9_ADDR A:0x6005c224
y.create.l HWIO_SEC_CTRL_HW_VERSION_ADDR A:0x6005e000
y.create.l HWIO_FEATURE_CONFIG0_ADDR A:0x6005e004
y.create.l HWIO_FEATURE_CONFIG1_ADDR A:0x6005e008
y.create.l HWIO_FEATURE_CONFIG2_ADDR A:0x6005e00c
y.create.l HWIO_FEATURE_CONFIG3_ADDR A:0x6005e010
y.create.l HWIO_FEATURE_CONFIG4_ADDR A:0x6005e014
y.create.l HWIO_FEATURE_CONFIG5_ADDR A:0x6005e018
y.create.l HWIO_OEM_CONFIG0_ADDR A:0x6005e01c
y.create.l HWIO_OEM_CONFIG1_ADDR A:0x6005e020
y.create.l HWIO_OEM_CONFIG2_ADDR A:0x6005e024
y.create.l HWIO_OEM_CONFIG3_ADDR A:0x6005e028
y.create.l HWIO_BOOT_CONFIG_ADDR A:0x6005e02c
y.create.l HWIO_SECURE_BOOT1_ADDR A:0x6005e034
y.create.l HWIO_SECURE_BOOT2_ADDR A:0x6005e038
y.create.l HWIO_SECURE_BOOT3_ADDR A:0x6005e03c
y.create.l HWIO_SECURE_BOOT4_ADDR A:0x6005e040
y.create.l HWIO_SECURE_BOOT5_ADDR A:0x6005e044
y.create.l HWIO_SECURE_BOOT6_ADDR A:0x6005e048
y.create.l HWIO_SECURE_BOOT7_ADDR A:0x6005e04c
y.create.l HWIO_OVERRIDE_0_ADDR A:0x6005e058
y.create.l HWIO_OVERRIDE_1_ADDR A:0x6005e05c
y.create.l HWIO_OVERRIDE_2_ADDR A:0x6005e060
y.create.l HWIO_OVERRIDE_3_ADDR A:0x6005e064
y.create.l HWIO_OVERRIDE_4_ADDR A:0x6005e068
y.create.l HWIO_CAPT_SEC_GPIO_ADDR A:0x6005e06c
y.create.l HWIO_APP_PROC_CFG_ADDR A:0x6005e070
y.create.l HWIO_MSS_PROC_CFG_ADDR A:0x6005e074
y.create.l HWIO_QFPROM_CLK_CTL_ADDR A:0x6005e078
y.create.l HWIO_JTAG_ID_ADDR A:0x6005e07c
y.create.l HWIO_OEM_ID_ADDR A:0x6005e080
y.create.l HWIO_TEST_BUS_SEL_ADDR A:0x6005e084
y.create.l HWIO_SPDM_DYN_SECURE_MODE_ADDR A:0x6005e088
y.create.l HWIO_SEC_CTRL_APU_XPU_SCR_ADDR A:0x6005f000
y.create.l HWIO_SEC_CTRL_APU_XPU_SWDR_ADDR A:0x6005f004
y.create.l HWIO_SEC_CTRL_APU_XPU_SEAR0_ADDR A:0x6005f040
y.create.l HWIO_SEC_CTRL_APU_XPU_SESR_ADDR A:0x6005f048
y.create.l HWIO_SEC_CTRL_APU_XPU_SESRRESTORE_ADDR A:0x6005f04c
y.create.l HWIO_SEC_CTRL_APU_XPU_SESYNR0_ADDR A:0x6005f050
y.create.l HWIO_SEC_CTRL_APU_XPU_SESYNR1_ADDR A:0x6005f054
y.create.l HWIO_SEC_CTRL_APU_XPU_SESYNR2_ADDR A:0x6005f058
y.create.l HWIO_SEC_CTRL_APU_XPU_MCR_ADDR A:0x6005f100
y.create.l HWIO_SEC_CTRL_APU_XPU_MEAR0_ADDR A:0x6005f140
y.create.l HWIO_SEC_CTRL_APU_XPU_MESR_ADDR A:0x6005f148
y.create.l HWIO_SEC_CTRL_APU_XPU_MESRRESTORE_ADDR A:0x6005f14c
y.create.l HWIO_SEC_CTRL_APU_XPU_MESYNR0_ADDR A:0x6005f150
y.create.l HWIO_SEC_CTRL_APU_XPU_MESYNR1_ADDR A:0x6005f154
y.create.l HWIO_SEC_CTRL_APU_XPU_MESYNR2_ADDR A:0x6005f158
y.create.l HWIO_SEC_CTRL_APU_XPU_CR_ADDR A:0x6005f080
y.create.l HWIO_SEC_CTRL_APU_XPU_RPU_ACR0_ADDR A:0x6005f0a0
y.create.l HWIO_SEC_CTRL_APU_XPU_EAR0_ADDR A:0x6005f0c0
y.create.l HWIO_SEC_CTRL_APU_XPU_ESR_ADDR A:0x6005f0c8
y.create.l HWIO_SEC_CTRL_APU_XPU_ESRRESTORE_ADDR A:0x6005f0cc
y.create.l HWIO_SEC_CTRL_APU_XPU_ESYNR0_ADDR A:0x6005f0d0
y.create.l HWIO_SEC_CTRL_APU_XPU_ESYNR1_ADDR A:0x6005f0d4
y.create.l HWIO_SEC_CTRL_APU_XPU_ESYNR2_ADDR A:0x6005f0d8
y.create.l HWIO_SEC_CTRL_APU_XPU_IDR0_ADDR A:0x6005f074
y.create.l HWIO_SEC_CTRL_APU_XPU_IDR1_ADDR A:0x6005f078
y.create.l HWIO_SEC_CTRL_APU_XPU_REV_ADDR A:0x6005f07c
y.create.l HWIO_SEC_CTRL_APU_XPU_RG0_RACR0_ADDR A:0x6005f200
y.create.l HWIO_SEC_CTRL_APU_XPU_RG1_RACR0_ADDR A:0x6005f280
y.create.l HWIO_SEC_CTRL_APU_XPU_RG2_RACR0_ADDR A:0x6005f300
y.create.l HWIO_SEC_CTRL_APU_XPU_RG3_RACR0_ADDR A:0x6005f380
y.create.l HWIO_SEC_CTRL_APU_XPU_RG4_RACR0_ADDR A:0x6005f400
y.create.l HWIO_SEC_CTRL_APU_XPU_RG5_RACR0_ADDR A:0x6005f480
y.create.l HWIO_SEC_CTRL_APU_XPU_RG6_RACR0_ADDR A:0x6005f500
y.create.l HWIO_SEC_CTRL_APU_XPU_RG7_RACR0_ADDR A:0x6005f580
y.create.l HWIO_SEC_CTRL_APU_XPU_RG8_RACR0_ADDR A:0x6005f600
y.create.l HWIO_SEC_CTRL_APU_XPU_RG9_RACR0_ADDR A:0x6005f680
y.create.l HWIO_SEC_CTRL_APU_XPU_RG0_WACR0_ADDR A:0x6005f220
y.create.l HWIO_SEC_CTRL_APU_XPU_RG1_WACR0_ADDR A:0x6005f2a0
y.create.l HWIO_SEC_CTRL_APU_XPU_RG2_WACR0_ADDR A:0x6005f320
y.create.l HWIO_SEC_CTRL_APU_XPU_RG3_WACR0_ADDR A:0x6005f3a0
y.create.l HWIO_SEC_CTRL_APU_XPU_RG4_WACR0_ADDR A:0x6005f420
y.create.l HWIO_SEC_CTRL_APU_XPU_RG5_WACR0_ADDR A:0x6005f4a0
y.create.l HWIO_SEC_CTRL_APU_XPU_RG6_WACR0_ADDR A:0x6005f520
y.create.l HWIO_SEC_CTRL_APU_XPU_RG7_WACR0_ADDR A:0x6005f5a0
y.create.l HWIO_SEC_CTRL_APU_XPU_RG8_WACR0_ADDR A:0x6005f620
y.create.l HWIO_SEC_CTRL_APU_XPU_RG9_WACR0_ADDR A:0x6005f6a0
y.create.l HWIO_SEC_CTRL_APU_XPU_RG0_SCR_ADDR A:0x6005f250
y.create.l HWIO_SEC_CTRL_APU_XPU_RG1_SCR_ADDR A:0x6005f2d0
y.create.l HWIO_SEC_CTRL_APU_XPU_RG2_SCR_ADDR A:0x6005f350
y.create.l HWIO_SEC_CTRL_APU_XPU_RG3_SCR_ADDR A:0x6005f3d0
y.create.l HWIO_SEC_CTRL_APU_XPU_RG4_SCR_ADDR A:0x6005f450
y.create.l HWIO_SEC_CTRL_APU_XPU_RG5_SCR_ADDR A:0x6005f4d0
y.create.l HWIO_SEC_CTRL_APU_XPU_RG6_SCR_ADDR A:0x6005f550
y.create.l HWIO_SEC_CTRL_APU_XPU_RG7_SCR_ADDR A:0x6005f5d0
y.create.l HWIO_SEC_CTRL_APU_XPU_RG8_SCR_ADDR A:0x6005f650
y.create.l HWIO_SEC_CTRL_APU_XPU_RG9_SCR_ADDR A:0x6005f6d0
y.create.l HWIO_SEC_CTRL_APU_XPU_RG0_MCR_ADDR A:0x6005f254
y.create.l HWIO_SEC_CTRL_APU_XPU_RG1_MCR_ADDR A:0x6005f2d4
y.create.l HWIO_SEC_CTRL_APU_XPU_RG2_MCR_ADDR A:0x6005f354
y.create.l HWIO_SEC_CTRL_APU_XPU_RG3_MCR_ADDR A:0x6005f3d4
y.create.l HWIO_SEC_CTRL_APU_XPU_RG4_MCR_ADDR A:0x6005f454
y.create.l HWIO_SEC_CTRL_APU_XPU_RG5_MCR_ADDR A:0x6005f4d4
y.create.l HWIO_SEC_CTRL_APU_XPU_RG6_MCR_ADDR A:0x6005f554
y.create.l HWIO_SEC_CTRL_APU_XPU_RG7_MCR_ADDR A:0x6005f5d4
y.create.l HWIO_SEC_CTRL_APU_XPU_RG8_MCR_ADDR A:0x6005f654
y.create.l HWIO_SEC_CTRL_APU_XPU_RG9_MCR_ADDR A:0x6005f6d4
y.create.l HWIO_TCU_XPU_SCR_TCU_ADDR A:0x60034000
y.create.l HWIO_TCU_XPU_SWDR_TCU_ADDR A:0x60034004
y.create.l HWIO_TCU_XPU_PRTN_RACR_SSHADOW_TCU_ADDR A:0x60034008
y.create.l HWIO_TCU_XPU_PRTN_WACR_SSHADOW_TCU_ADDR A:0x6003400c
y.create.l HWIO_TCU_XPU_PRTN_START_SSHADOW0_TCU_ADDR A:0x60034010
y.create.l HWIO_TCU_XPU_PRTN_END_SSHADOW0_TCU_ADDR A:0x60034018
y.create.l HWIO_TCU_XPU_SEAR0_TCU_ADDR A:0x60034040
y.create.l HWIO_TCU_XPU_SESR_TCU_ADDR A:0x60034048
y.create.l HWIO_TCU_XPU_SESRRESTORE_TCU_ADDR A:0x6003404c
y.create.l HWIO_TCU_XPU_SESYNR0_TCU_ADDR A:0x60034050
y.create.l HWIO_TCU_XPU_SESYNR1_TCU_ADDR A:0x60034054
y.create.l HWIO_TCU_XPU_SESYNR2_TCU_ADDR A:0x60034058
y.create.l HWIO_TCU_XPU_MCR_TCU_ADDR A:0x60034100
y.create.l HWIO_TCU_XPU_MEAR0_TCU_ADDR A:0x60034140
y.create.l HWIO_TCU_XPU_MESR_TCU_ADDR A:0x60034148
y.create.l HWIO_TCU_XPU_MESRRESTORE_TCU_ADDR A:0x6003414c
y.create.l HWIO_TCU_XPU_MESYNR0_TCU_ADDR A:0x60034150
y.create.l HWIO_TCU_XPU_MESYNR1_TCU_ADDR A:0x60034154
y.create.l HWIO_TCU_XPU_MESYNR2_TCU_ADDR A:0x60034158
y.create.l HWIO_TCU_XPU_CR_TCU_ADDR A:0x60034080
y.create.l HWIO_TCU_XPU_PRTN_RACR_SHADOW_TCU_ADDR A:0x60034088
y.create.l HWIO_TCU_XPU_PRTN_WACR_SHADOW_TCU_ADDR A:0x6003408c
y.create.l HWIO_TCU_XPU_PRTN_START_SHADOW0_TCU_ADDR A:0x60034090
y.create.l HWIO_TCU_XPU_PRTN_END_SHADOW0_TCU_ADDR A:0x60034098
y.create.l HWIO_TCU_XPU_RPU_ACR0_TCU_ADDR A:0x600340a0
y.create.l HWIO_TCU_XPU_EAR0_TCU_ADDR A:0x600340c0
y.create.l HWIO_TCU_XPU_ESR_TCU_ADDR A:0x600340c8
y.create.l HWIO_TCU_XPU_ESRRESTORE_TCU_ADDR A:0x600340cc
y.create.l HWIO_TCU_XPU_ESYNR0_TCU_ADDR A:0x600340d0
y.create.l HWIO_TCU_XPU_ESYNR1_TCU_ADDR A:0x600340d4
y.create.l HWIO_TCU_XPU_ESYNR2_TCU_ADDR A:0x600340d8
y.create.l HWIO_TCU_XPU_UMR_RACR_TCU_ADDR A:0x600340e0
y.create.l HWIO_TCU_XPU_UMR_WACR_TCU_ADDR A:0x600340e4
y.create.l HWIO_TCU_XPU_UMR_CNTL_TCU_ADDR A:0x600340f0
y.create.l HWIO_TCU_XPU_IDR0_TCU_ADDR A:0x60034074
y.create.l HWIO_TCU_XPU_IDR1_TCU_ADDR A:0x60034078
y.create.l HWIO_TCU_XPU_REV_TCU_ADDR A:0x6003407c
y.create.l HWIO_TCU_XPU_PRT0_RACR0_TCU_ADDR A:0x60034200
y.create.l HWIO_TCU_XPU_PRT1_RACR0_TCU_ADDR A:0x60034280
y.create.l HWIO_TCU_XPU_PRT2_RACR0_TCU_ADDR A:0x60034300
y.create.l HWIO_TCU_XPU_PRT3_RACR0_TCU_ADDR A:0x60034380
y.create.l HWIO_TCU_XPU_PRT4_RACR0_TCU_ADDR A:0x60034400
y.create.l HWIO_TCU_XPU_PRT5_RACR0_TCU_ADDR A:0x60034480
y.create.l HWIO_TCU_XPU_PRT6_RACR0_TCU_ADDR A:0x60034500
y.create.l HWIO_TCU_XPU_PRT7_RACR0_TCU_ADDR A:0x60034580
y.create.l HWIO_TCU_XPU_PRT8_RACR0_TCU_ADDR A:0x60034600
y.create.l HWIO_TCU_XPU_PRT9_RACR0_TCU_ADDR A:0x60034680
y.create.l HWIO_TCU_XPU_PRT0_WACR0_TCU_ADDR A:0x60034220
y.create.l HWIO_TCU_XPU_PRT1_WACR0_TCU_ADDR A:0x600342a0
y.create.l HWIO_TCU_XPU_PRT2_WACR0_TCU_ADDR A:0x60034320
y.create.l HWIO_TCU_XPU_PRT3_WACR0_TCU_ADDR A:0x600343a0
y.create.l HWIO_TCU_XPU_PRT4_WACR0_TCU_ADDR A:0x60034420
y.create.l HWIO_TCU_XPU_PRT5_WACR0_TCU_ADDR A:0x600344a0
y.create.l HWIO_TCU_XPU_PRT6_WACR0_TCU_ADDR A:0x60034520
y.create.l HWIO_TCU_XPU_PRT7_WACR0_TCU_ADDR A:0x600345a0
y.create.l HWIO_TCU_XPU_PRT8_WACR0_TCU_ADDR A:0x60034620
y.create.l HWIO_TCU_XPU_PRT9_WACR0_TCU_ADDR A:0x600346a0
y.create.l HWIO_TCU_XPU_PRT0_START0_TCU_ADDR A:0x60034240
y.create.l HWIO_TCU_XPU_PRT1_START0_TCU_ADDR A:0x600342c0
y.create.l HWIO_TCU_XPU_PRT2_START0_TCU_ADDR A:0x60034340
y.create.l HWIO_TCU_XPU_PRT3_START0_TCU_ADDR A:0x600343c0
y.create.l HWIO_TCU_XPU_PRT4_START0_TCU_ADDR A:0x60034440
y.create.l HWIO_TCU_XPU_PRT5_START0_TCU_ADDR A:0x600344c0
y.create.l HWIO_TCU_XPU_PRT6_START0_TCU_ADDR A:0x60034540
y.create.l HWIO_TCU_XPU_PRT7_START0_TCU_ADDR A:0x600345c0
y.create.l HWIO_TCU_XPU_PRT8_START0_TCU_ADDR A:0x60034640
y.create.l HWIO_TCU_XPU_PRT9_START0_TCU_ADDR A:0x600346c0
y.create.l HWIO_TCU_XPU_PRT0_END0_TCU_ADDR A:0x60034248
y.create.l HWIO_TCU_XPU_PRT1_END0_TCU_ADDR A:0x600342c8
y.create.l HWIO_TCU_XPU_PRT2_END0_TCU_ADDR A:0x60034348
y.create.l HWIO_TCU_XPU_PRT3_END0_TCU_ADDR A:0x600343c8
y.create.l HWIO_TCU_XPU_PRT4_END0_TCU_ADDR A:0x60034448
y.create.l HWIO_TCU_XPU_PRT5_END0_TCU_ADDR A:0x600344c8
y.create.l HWIO_TCU_XPU_PRT6_END0_TCU_ADDR A:0x60034548
y.create.l HWIO_TCU_XPU_PRT7_END0_TCU_ADDR A:0x600345c8
y.create.l HWIO_TCU_XPU_PRT8_END0_TCU_ADDR A:0x60034648
y.create.l HWIO_TCU_XPU_PRT9_END0_TCU_ADDR A:0x600346c8
y.create.l HWIO_TCU_XPU_PRT0_SCR_TCU_ADDR A:0x60034250
y.create.l HWIO_TCU_XPU_PRT1_SCR_TCU_ADDR A:0x600342d0
y.create.l HWIO_TCU_XPU_PRT2_SCR_TCU_ADDR A:0x60034350
y.create.l HWIO_TCU_XPU_PRT3_SCR_TCU_ADDR A:0x600343d0
y.create.l HWIO_TCU_XPU_PRT4_SCR_TCU_ADDR A:0x60034450
y.create.l HWIO_TCU_XPU_PRT5_SCR_TCU_ADDR A:0x600344d0
y.create.l HWIO_TCU_XPU_PRT6_SCR_TCU_ADDR A:0x60034550
y.create.l HWIO_TCU_XPU_PRT7_SCR_TCU_ADDR A:0x600345d0
y.create.l HWIO_TCU_XPU_PRT8_SCR_TCU_ADDR A:0x60034650
y.create.l HWIO_TCU_XPU_PRT9_SCR_TCU_ADDR A:0x600346d0
y.create.l HWIO_TCU_XPU_PRT0_MCR_TCU_ADDR A:0x60034254
y.create.l HWIO_TCU_XPU_PRT1_MCR_TCU_ADDR A:0x600342d4
y.create.l HWIO_TCU_XPU_PRT2_MCR_TCU_ADDR A:0x60034354
y.create.l HWIO_TCU_XPU_PRT3_MCR_TCU_ADDR A:0x600343d4
y.create.l HWIO_TCU_XPU_PRT4_MCR_TCU_ADDR A:0x60034454
y.create.l HWIO_TCU_XPU_PRT5_MCR_TCU_ADDR A:0x600344d4
y.create.l HWIO_TCU_XPU_PRT6_MCR_TCU_ADDR A:0x60034554
y.create.l HWIO_TCU_XPU_PRT7_MCR_TCU_ADDR A:0x600345d4
y.create.l HWIO_TCU_XPU_PRT8_MCR_TCU_ADDR A:0x60034654
y.create.l HWIO_TCU_XPU_PRT9_MCR_TCU_ADDR A:0x600346d4
y.create.l HWIO_TCU_XPU_PRT0_CNTL0_TCU_ADDR A:0x60034258
y.create.l HWIO_TCU_XPU_PRT1_CNTL0_TCU_ADDR A:0x600342d8
y.create.l HWIO_TCU_XPU_PRT2_CNTL0_TCU_ADDR A:0x60034358
y.create.l HWIO_TCU_XPU_PRT3_CNTL0_TCU_ADDR A:0x600343d8
y.create.l HWIO_TCU_XPU_PRT4_CNTL0_TCU_ADDR A:0x60034458
y.create.l HWIO_TCU_XPU_PRT5_CNTL0_TCU_ADDR A:0x600344d8
y.create.l HWIO_TCU_XPU_PRT6_CNTL0_TCU_ADDR A:0x60034558
y.create.l HWIO_TCU_XPU_PRT7_CNTL0_TCU_ADDR A:0x600345d8
y.create.l HWIO_TCU_XPU_PRT8_CNTL0_TCU_ADDR A:0x60034658
y.create.l HWIO_TCU_XPU_PRT9_CNTL0_TCU_ADDR A:0x600346d8
y.create.l HWIO_TCU_XPU_PRT0_CNTL1_TCU_ADDR A:0x6003425c
y.create.l HWIO_TCU_XPU_PRT1_CNTL1_TCU_ADDR A:0x600342dc
y.create.l HWIO_TCU_XPU_PRT2_CNTL1_TCU_ADDR A:0x6003435c
y.create.l HWIO_TCU_XPU_PRT3_CNTL1_TCU_ADDR A:0x600343dc
y.create.l HWIO_TCU_XPU_PRT4_CNTL1_TCU_ADDR A:0x6003445c
y.create.l HWIO_TCU_XPU_PRT5_CNTL1_TCU_ADDR A:0x600344dc
y.create.l HWIO_TCU_XPU_PRT6_CNTL1_TCU_ADDR A:0x6003455c
y.create.l HWIO_TCU_XPU_PRT7_CNTL1_TCU_ADDR A:0x600345dc
y.create.l HWIO_TCU_XPU_PRT8_CNTL1_TCU_ADDR A:0x6003465c
y.create.l HWIO_TCU_XPU_PRT9_CNTL1_TCU_ADDR A:0x600346dc
y.create.l HWIO_DIME_XPU_SCR_DIME_ADDR A:0x60035000
y.create.l HWIO_DIME_XPU_SWDR_DIME_ADDR A:0x60035004
y.create.l HWIO_DIME_XPU_PRTN_RACR_SSHADOW_DIME_ADDR A:0x60035008
y.create.l HWIO_DIME_XPU_PRTN_START_SSHADOW0_DIME_ADDR A:0x60035010
y.create.l HWIO_DIME_XPU_PRTN_END_SSHADOW0_DIME_ADDR A:0x60035018
y.create.l HWIO_DIME_XPU_SEAR0_DIME_ADDR A:0x60035040
y.create.l HWIO_DIME_XPU_SESR_DIME_ADDR A:0x60035048
y.create.l HWIO_DIME_XPU_SESRRESTORE_DIME_ADDR A:0x6003504c
y.create.l HWIO_DIME_XPU_SESYNR0_DIME_ADDR A:0x60035050
y.create.l HWIO_DIME_XPU_SESYNR1_DIME_ADDR A:0x60035054
y.create.l HWIO_DIME_XPU_SESYNR2_DIME_ADDR A:0x60035058
y.create.l HWIO_DIME_XPU_MCR_DIME_ADDR A:0x60035100
y.create.l HWIO_DIME_XPU_MEAR0_DIME_ADDR A:0x60035140
y.create.l HWIO_DIME_XPU_MESR_DIME_ADDR A:0x60035148
y.create.l HWIO_DIME_XPU_MESRRESTORE_DIME_ADDR A:0x6003514c
y.create.l HWIO_DIME_XPU_MESYNR0_DIME_ADDR A:0x60035150
y.create.l HWIO_DIME_XPU_MESYNR1_DIME_ADDR A:0x60035154
y.create.l HWIO_DIME_XPU_MESYNR2_DIME_ADDR A:0x60035158
y.create.l HWIO_DIME_XPU_CR_DIME_ADDR A:0x60035080
y.create.l HWIO_DIME_XPU_PRTN_RACR_SHADOW_DIME_ADDR A:0x60035088
y.create.l HWIO_DIME_XPU_PRTN_START_SHADOW0_DIME_ADDR A:0x60035090
y.create.l HWIO_DIME_XPU_PRTN_END_SHADOW0_DIME_ADDR A:0x60035098
y.create.l HWIO_DIME_XPU_RPU_ACR0_DIME_ADDR A:0x600350a0
y.create.l HWIO_DIME_XPU_EAR0_DIME_ADDR A:0x600350c0
y.create.l HWIO_DIME_XPU_ESR_DIME_ADDR A:0x600350c8
y.create.l HWIO_DIME_XPU_ESRRESTORE_DIME_ADDR A:0x600350cc
y.create.l HWIO_DIME_XPU_ESYNR0_DIME_ADDR A:0x600350d0
y.create.l HWIO_DIME_XPU_ESYNR1_DIME_ADDR A:0x600350d4
y.create.l HWIO_DIME_XPU_ESYNR2_DIME_ADDR A:0x600350d8
y.create.l HWIO_DIME_XPU_UMR_RACR_DIME_ADDR A:0x600350e0
y.create.l HWIO_DIME_XPU_UMR_WACR_DIME_ADDR A:0x600350e4
y.create.l HWIO_DIME_XPU_UMR_CNTL_DIME_ADDR A:0x600350f0
y.create.l HWIO_DIME_XPU_IDR0_DIME_ADDR A:0x60035074
y.create.l HWIO_DIME_XPU_IDR1_DIME_ADDR A:0x60035078
y.create.l HWIO_DIME_XPU_REV_DIME_ADDR A:0x6003507c
y.create.l HWIO_DIME_XPU_PRT0_RACR0_DIME_ADDR A:0x60035200
y.create.l HWIO_DIME_XPU_PRT1_RACR0_DIME_ADDR A:0x60035280
y.create.l HWIO_DIME_XPU_PRT2_RACR0_DIME_ADDR A:0x60035300
y.create.l HWIO_DIME_XPU_PRT3_RACR0_DIME_ADDR A:0x60035380
y.create.l HWIO_DIME_XPU_PRT4_RACR0_DIME_ADDR A:0x60035400
y.create.l HWIO_DIME_XPU_PRT5_RACR0_DIME_ADDR A:0x60035480
y.create.l HWIO_DIME_XPU_PRT6_RACR0_DIME_ADDR A:0x60035500
y.create.l HWIO_DIME_XPU_PRT7_RACR0_DIME_ADDR A:0x60035580
y.create.l HWIO_DIME_XPU_PRT8_RACR0_DIME_ADDR A:0x60035600
y.create.l HWIO_DIME_XPU_PRT9_RACR0_DIME_ADDR A:0x60035680
y.create.l HWIO_DIME_XPU_PRT0_START0_DIME_ADDR A:0x60035240
y.create.l HWIO_DIME_XPU_PRT1_START0_DIME_ADDR A:0x600352c0
y.create.l HWIO_DIME_XPU_PRT2_START0_DIME_ADDR A:0x60035340
y.create.l HWIO_DIME_XPU_PRT3_START0_DIME_ADDR A:0x600353c0
y.create.l HWIO_DIME_XPU_PRT4_START0_DIME_ADDR A:0x60035440
y.create.l HWIO_DIME_XPU_PRT5_START0_DIME_ADDR A:0x600354c0
y.create.l HWIO_DIME_XPU_PRT6_START0_DIME_ADDR A:0x60035540
y.create.l HWIO_DIME_XPU_PRT7_START0_DIME_ADDR A:0x600355c0
y.create.l HWIO_DIME_XPU_PRT8_START0_DIME_ADDR A:0x60035640
y.create.l HWIO_DIME_XPU_PRT9_START0_DIME_ADDR A:0x600356c0
y.create.l HWIO_DIME_XPU_PRT0_END0_DIME_ADDR A:0x60035248
y.create.l HWIO_DIME_XPU_PRT1_END0_DIME_ADDR A:0x600352c8
y.create.l HWIO_DIME_XPU_PRT2_END0_DIME_ADDR A:0x60035348
y.create.l HWIO_DIME_XPU_PRT3_END0_DIME_ADDR A:0x600353c8
y.create.l HWIO_DIME_XPU_PRT4_END0_DIME_ADDR A:0x60035448
y.create.l HWIO_DIME_XPU_PRT5_END0_DIME_ADDR A:0x600354c8
y.create.l HWIO_DIME_XPU_PRT6_END0_DIME_ADDR A:0x60035548
y.create.l HWIO_DIME_XPU_PRT7_END0_DIME_ADDR A:0x600355c8
y.create.l HWIO_DIME_XPU_PRT8_END0_DIME_ADDR A:0x60035648
y.create.l HWIO_DIME_XPU_PRT9_END0_DIME_ADDR A:0x600356c8
y.create.l HWIO_DIME_XPU_PRT0_SCR_DIME_ADDR A:0x60035250
y.create.l HWIO_DIME_XPU_PRT1_SCR_DIME_ADDR A:0x600352d0
y.create.l HWIO_DIME_XPU_PRT2_SCR_DIME_ADDR A:0x60035350
y.create.l HWIO_DIME_XPU_PRT3_SCR_DIME_ADDR A:0x600353d0
y.create.l HWIO_DIME_XPU_PRT4_SCR_DIME_ADDR A:0x60035450
y.create.l HWIO_DIME_XPU_PRT5_SCR_DIME_ADDR A:0x600354d0
y.create.l HWIO_DIME_XPU_PRT6_SCR_DIME_ADDR A:0x60035550
y.create.l HWIO_DIME_XPU_PRT7_SCR_DIME_ADDR A:0x600355d0
y.create.l HWIO_DIME_XPU_PRT8_SCR_DIME_ADDR A:0x60035650
y.create.l HWIO_DIME_XPU_PRT9_SCR_DIME_ADDR A:0x600356d0
y.create.l HWIO_DIME_XPU_PRT0_MCR_DIME_ADDR A:0x60035254
y.create.l HWIO_DIME_XPU_PRT1_MCR_DIME_ADDR A:0x600352d4
y.create.l HWIO_DIME_XPU_PRT2_MCR_DIME_ADDR A:0x60035354
y.create.l HWIO_DIME_XPU_PRT3_MCR_DIME_ADDR A:0x600353d4
y.create.l HWIO_DIME_XPU_PRT4_MCR_DIME_ADDR A:0x60035454
y.create.l HWIO_DIME_XPU_PRT5_MCR_DIME_ADDR A:0x600354d4
y.create.l HWIO_DIME_XPU_PRT6_MCR_DIME_ADDR A:0x60035554
y.create.l HWIO_DIME_XPU_PRT7_MCR_DIME_ADDR A:0x600355d4
y.create.l HWIO_DIME_XPU_PRT8_MCR_DIME_ADDR A:0x60035654
y.create.l HWIO_DIME_XPU_PRT9_MCR_DIME_ADDR A:0x600356d4
y.create.l HWIO_DIME_XPU_PRT0_CNTL0_DIME_ADDR A:0x60035258
y.create.l HWIO_DIME_XPU_PRT1_CNTL0_DIME_ADDR A:0x600352d8
y.create.l HWIO_DIME_XPU_PRT2_CNTL0_DIME_ADDR A:0x60035358
y.create.l HWIO_DIME_XPU_PRT3_CNTL0_DIME_ADDR A:0x600353d8
y.create.l HWIO_DIME_XPU_PRT4_CNTL0_DIME_ADDR A:0x60035458
y.create.l HWIO_DIME_XPU_PRT5_CNTL0_DIME_ADDR A:0x600354d8
y.create.l HWIO_DIME_XPU_PRT6_CNTL0_DIME_ADDR A:0x60035558
y.create.l HWIO_DIME_XPU_PRT7_CNTL0_DIME_ADDR A:0x600355d8
y.create.l HWIO_DIME_XPU_PRT8_CNTL0_DIME_ADDR A:0x60035658
y.create.l HWIO_DIME_XPU_PRT9_CNTL0_DIME_ADDR A:0x600356d8
y.create.l HWIO_DIME_XPU_PRT0_CNTL1_DIME_ADDR A:0x6003525c
y.create.l HWIO_DIME_XPU_PRT1_CNTL1_DIME_ADDR A:0x600352dc
y.create.l HWIO_DIME_XPU_PRT2_CNTL1_DIME_ADDR A:0x6003535c
y.create.l HWIO_DIME_XPU_PRT3_CNTL1_DIME_ADDR A:0x600353dc
y.create.l HWIO_DIME_XPU_PRT4_CNTL1_DIME_ADDR A:0x6003545c
y.create.l HWIO_DIME_XPU_PRT5_CNTL1_DIME_ADDR A:0x600354dc
y.create.l HWIO_DIME_XPU_PRT6_CNTL1_DIME_ADDR A:0x6003555c
y.create.l HWIO_DIME_XPU_PRT7_CNTL1_DIME_ADDR A:0x600355dc
y.create.l HWIO_DIME_XPU_PRT8_CNTL1_DIME_ADDR A:0x6003565c
y.create.l HWIO_DIME_XPU_PRT9_CNTL1_DIME_ADDR A:0x600356dc
y.create.l HWIO_GPS_XPU_SCR_GPS_ADDR A:0x60036000
y.create.l HWIO_GPS_XPU_SWDR_GPS_ADDR A:0x60036004
y.create.l HWIO_GPS_XPU_PRTN_RACR_SSHADOW_GPS_ADDR A:0x60036008
y.create.l HWIO_GPS_XPU_PRTN_START_SSHADOW0_GPS_ADDR A:0x60036010
y.create.l HWIO_GPS_XPU_PRTN_END_SSHADOW0_GPS_ADDR A:0x60036018
y.create.l HWIO_GPS_XPU_SEAR0_GPS_ADDR A:0x60036040
y.create.l HWIO_GPS_XPU_SESR_GPS_ADDR A:0x60036048
y.create.l HWIO_GPS_XPU_SESRRESTORE_GPS_ADDR A:0x6003604c
y.create.l HWIO_GPS_XPU_SESYNR0_GPS_ADDR A:0x60036050
y.create.l HWIO_GPS_XPU_SESYNR1_GPS_ADDR A:0x60036054
y.create.l HWIO_GPS_XPU_SESYNR2_GPS_ADDR A:0x60036058
y.create.l HWIO_GPS_XPU_MCR_GPS_ADDR A:0x60036100
y.create.l HWIO_GPS_XPU_MEAR0_GPS_ADDR A:0x60036140
y.create.l HWIO_GPS_XPU_MESR_GPS_ADDR A:0x60036148
y.create.l HWIO_GPS_XPU_MESRRESTORE_GPS_ADDR A:0x6003614c
y.create.l HWIO_GPS_XPU_MESYNR0_GPS_ADDR A:0x60036150
y.create.l HWIO_GPS_XPU_MESYNR1_GPS_ADDR A:0x60036154
y.create.l HWIO_GPS_XPU_MESYNR2_GPS_ADDR A:0x60036158
y.create.l HWIO_GPS_XPU_CR_GPS_ADDR A:0x60036080
y.create.l HWIO_GPS_XPU_PRTN_RACR_SHADOW_GPS_ADDR A:0x60036088
y.create.l HWIO_GPS_XPU_PRTN_START_SHADOW0_GPS_ADDR A:0x60036090
y.create.l HWIO_GPS_XPU_PRTN_END_SHADOW0_GPS_ADDR A:0x60036098
y.create.l HWIO_GPS_XPU_RPU_ACR0_GPS_ADDR A:0x600360a0
y.create.l HWIO_GPS_XPU_EAR0_GPS_ADDR A:0x600360c0
y.create.l HWIO_GPS_XPU_ESR_GPS_ADDR A:0x600360c8
y.create.l HWIO_GPS_XPU_ESRRESTORE_GPS_ADDR A:0x600360cc
y.create.l HWIO_GPS_XPU_ESYNR0_GPS_ADDR A:0x600360d0
y.create.l HWIO_GPS_XPU_ESYNR1_GPS_ADDR A:0x600360d4
y.create.l HWIO_GPS_XPU_ESYNR2_GPS_ADDR A:0x600360d8
y.create.l HWIO_GPS_XPU_UMR_RACR_GPS_ADDR A:0x600360e0
y.create.l HWIO_GPS_XPU_UMR_WACR_GPS_ADDR A:0x600360e4
y.create.l HWIO_GPS_XPU_UMR_CNTL_GPS_ADDR A:0x600360f0
y.create.l HWIO_GPS_XPU_IDR0_GPS_ADDR A:0x60036074
y.create.l HWIO_GPS_XPU_IDR1_GPS_ADDR A:0x60036078
y.create.l HWIO_GPS_XPU_REV_GPS_ADDR A:0x6003607c
y.create.l HWIO_GPS_XPU_PRT0_RACR0_GPS_ADDR A:0x60036200
y.create.l HWIO_GPS_XPU_PRT1_RACR0_GPS_ADDR A:0x60036280
y.create.l HWIO_GPS_XPU_PRT2_RACR0_GPS_ADDR A:0x60036300
y.create.l HWIO_GPS_XPU_PRT3_RACR0_GPS_ADDR A:0x60036380
y.create.l HWIO_GPS_XPU_PRT4_RACR0_GPS_ADDR A:0x60036400
y.create.l HWIO_GPS_XPU_PRT5_RACR0_GPS_ADDR A:0x60036480
y.create.l HWIO_GPS_XPU_PRT6_RACR0_GPS_ADDR A:0x60036500
y.create.l HWIO_GPS_XPU_PRT7_RACR0_GPS_ADDR A:0x60036580
y.create.l HWIO_GPS_XPU_PRT8_RACR0_GPS_ADDR A:0x60036600
y.create.l HWIO_GPS_XPU_PRT9_RACR0_GPS_ADDR A:0x60036680
y.create.l HWIO_GPS_XPU_PRT0_START0_GPS_ADDR A:0x60036240
y.create.l HWIO_GPS_XPU_PRT1_START0_GPS_ADDR A:0x600362c0
y.create.l HWIO_GPS_XPU_PRT2_START0_GPS_ADDR A:0x60036340
y.create.l HWIO_GPS_XPU_PRT3_START0_GPS_ADDR A:0x600363c0
y.create.l HWIO_GPS_XPU_PRT4_START0_GPS_ADDR A:0x60036440
y.create.l HWIO_GPS_XPU_PRT5_START0_GPS_ADDR A:0x600364c0
y.create.l HWIO_GPS_XPU_PRT6_START0_GPS_ADDR A:0x60036540
y.create.l HWIO_GPS_XPU_PRT7_START0_GPS_ADDR A:0x600365c0
y.create.l HWIO_GPS_XPU_PRT8_START0_GPS_ADDR A:0x60036640
y.create.l HWIO_GPS_XPU_PRT9_START0_GPS_ADDR A:0x600366c0
y.create.l HWIO_GPS_XPU_PRT0_END0_GPS_ADDR A:0x60036248
y.create.l HWIO_GPS_XPU_PRT1_END0_GPS_ADDR A:0x600362c8
y.create.l HWIO_GPS_XPU_PRT2_END0_GPS_ADDR A:0x60036348
y.create.l HWIO_GPS_XPU_PRT3_END0_GPS_ADDR A:0x600363c8
y.create.l HWIO_GPS_XPU_PRT4_END0_GPS_ADDR A:0x60036448
y.create.l HWIO_GPS_XPU_PRT5_END0_GPS_ADDR A:0x600364c8
y.create.l HWIO_GPS_XPU_PRT6_END0_GPS_ADDR A:0x60036548
y.create.l HWIO_GPS_XPU_PRT7_END0_GPS_ADDR A:0x600365c8
y.create.l HWIO_GPS_XPU_PRT8_END0_GPS_ADDR A:0x60036648
y.create.l HWIO_GPS_XPU_PRT9_END0_GPS_ADDR A:0x600366c8
y.create.l HWIO_GPS_XPU_PRT0_SCR_GPS_ADDR A:0x60036250
y.create.l HWIO_GPS_XPU_PRT1_SCR_GPS_ADDR A:0x600362d0
y.create.l HWIO_GPS_XPU_PRT2_SCR_GPS_ADDR A:0x60036350
y.create.l HWIO_GPS_XPU_PRT3_SCR_GPS_ADDR A:0x600363d0
y.create.l HWIO_GPS_XPU_PRT4_SCR_GPS_ADDR A:0x60036450
y.create.l HWIO_GPS_XPU_PRT5_SCR_GPS_ADDR A:0x600364d0
y.create.l HWIO_GPS_XPU_PRT6_SCR_GPS_ADDR A:0x60036550
y.create.l HWIO_GPS_XPU_PRT7_SCR_GPS_ADDR A:0x600365d0
y.create.l HWIO_GPS_XPU_PRT8_SCR_GPS_ADDR A:0x60036650
y.create.l HWIO_GPS_XPU_PRT9_SCR_GPS_ADDR A:0x600366d0
y.create.l HWIO_GPS_XPU_PRT0_MCR_GPS_ADDR A:0x60036254
y.create.l HWIO_GPS_XPU_PRT1_MCR_GPS_ADDR A:0x600362d4
y.create.l HWIO_GPS_XPU_PRT2_MCR_GPS_ADDR A:0x60036354
y.create.l HWIO_GPS_XPU_PRT3_MCR_GPS_ADDR A:0x600363d4
y.create.l HWIO_GPS_XPU_PRT4_MCR_GPS_ADDR A:0x60036454
y.create.l HWIO_GPS_XPU_PRT5_MCR_GPS_ADDR A:0x600364d4
y.create.l HWIO_GPS_XPU_PRT6_MCR_GPS_ADDR A:0x60036554
y.create.l HWIO_GPS_XPU_PRT7_MCR_GPS_ADDR A:0x600365d4
y.create.l HWIO_GPS_XPU_PRT8_MCR_GPS_ADDR A:0x60036654
y.create.l HWIO_GPS_XPU_PRT9_MCR_GPS_ADDR A:0x600366d4
y.create.l HWIO_GPS_XPU_PRT0_CNTL0_GPS_ADDR A:0x60036258
y.create.l HWIO_GPS_XPU_PRT1_CNTL0_GPS_ADDR A:0x600362d8
y.create.l HWIO_GPS_XPU_PRT2_CNTL0_GPS_ADDR A:0x60036358
y.create.l HWIO_GPS_XPU_PRT3_CNTL0_GPS_ADDR A:0x600363d8
y.create.l HWIO_GPS_XPU_PRT4_CNTL0_GPS_ADDR A:0x60036458
y.create.l HWIO_GPS_XPU_PRT5_CNTL0_GPS_ADDR A:0x600364d8
y.create.l HWIO_GPS_XPU_PRT6_CNTL0_GPS_ADDR A:0x60036558
y.create.l HWIO_GPS_XPU_PRT7_CNTL0_GPS_ADDR A:0x600365d8
y.create.l HWIO_GPS_XPU_PRT8_CNTL0_GPS_ADDR A:0x60036658
y.create.l HWIO_GPS_XPU_PRT9_CNTL0_GPS_ADDR A:0x600366d8
y.create.l HWIO_GPS_XPU_PRT0_CNTL1_GPS_ADDR A:0x6003625c
y.create.l HWIO_GPS_XPU_PRT1_CNTL1_GPS_ADDR A:0x600362dc
y.create.l HWIO_GPS_XPU_PRT2_CNTL1_GPS_ADDR A:0x6003635c
y.create.l HWIO_GPS_XPU_PRT3_CNTL1_GPS_ADDR A:0x600363dc
y.create.l HWIO_GPS_XPU_PRT4_CNTL1_GPS_ADDR A:0x6003645c
y.create.l HWIO_GPS_XPU_PRT5_CNTL1_GPS_ADDR A:0x600364dc
y.create.l HWIO_GPS_XPU_PRT6_CNTL1_GPS_ADDR A:0x6003655c
y.create.l HWIO_GPS_XPU_PRT7_CNTL1_GPS_ADDR A:0x600365dc
y.create.l HWIO_GPS_XPU_PRT8_CNTL1_GPS_ADDR A:0x6003665c
y.create.l HWIO_GPS_XPU_PRT9_CNTL1_GPS_ADDR A:0x600366dc
y.create.l HWIO_QDSP_XPU_SCR_QDSP_ADDR A:0x60037000
y.create.l HWIO_QDSP_XPU_SWDR_QDSP_ADDR A:0x60037004
y.create.l HWIO_QDSP_XPU_PRTN_RACR_SSHADOW_QDSP_ADDR A:0x60037008
y.create.l HWIO_QDSP_XPU_PRTN_START_SSHADOW0_QDSP_ADDR A:0x60037010
y.create.l HWIO_QDSP_XPU_PRTN_END_SSHADOW0_QDSP_ADDR A:0x60037018
y.create.l HWIO_QDSP_XPU_SEAR0_QDSP_ADDR A:0x60037040
y.create.l HWIO_QDSP_XPU_SESR_QDSP_ADDR A:0x60037048
y.create.l HWIO_QDSP_XPU_SESRRESTORE_QDSP_ADDR A:0x6003704c
y.create.l HWIO_QDSP_XPU_SESYNR0_QDSP_ADDR A:0x60037050
y.create.l HWIO_QDSP_XPU_SESYNR1_QDSP_ADDR A:0x60037054
y.create.l HWIO_QDSP_XPU_SESYNR2_QDSP_ADDR A:0x60037058
y.create.l HWIO_QDSP_XPU_MCR_QDSP_ADDR A:0x60037100
y.create.l HWIO_QDSP_XPU_MEAR0_QDSP_ADDR A:0x60037140
y.create.l HWIO_QDSP_XPU_MESR_QDSP_ADDR A:0x60037148
y.create.l HWIO_QDSP_XPU_MESRRESTORE_QDSP_ADDR A:0x6003714c
y.create.l HWIO_QDSP_XPU_MESYNR0_QDSP_ADDR A:0x60037150
y.create.l HWIO_QDSP_XPU_MESYNR1_QDSP_ADDR A:0x60037154
y.create.l HWIO_QDSP_XPU_MESYNR2_QDSP_ADDR A:0x60037158
y.create.l HWIO_QDSP_XPU_CR_QDSP_ADDR A:0x60037080
y.create.l HWIO_QDSP_XPU_PRTN_RACR_SHADOW_QDSP_ADDR A:0x60037088
y.create.l HWIO_QDSP_XPU_PRTN_START_SHADOW0_QDSP_ADDR A:0x60037090
y.create.l HWIO_QDSP_XPU_PRTN_END_SHADOW0_QDSP_ADDR A:0x60037098
y.create.l HWIO_QDSP_XPU_RPU_ACR0_QDSP_ADDR A:0x600370a0
y.create.l HWIO_QDSP_XPU_EAR0_QDSP_ADDR A:0x600370c0
y.create.l HWIO_QDSP_XPU_ESR_QDSP_ADDR A:0x600370c8
y.create.l HWIO_QDSP_XPU_ESRRESTORE_QDSP_ADDR A:0x600370cc
y.create.l HWIO_QDSP_XPU_ESYNR0_QDSP_ADDR A:0x600370d0
y.create.l HWIO_QDSP_XPU_ESYNR1_QDSP_ADDR A:0x600370d4
y.create.l HWIO_QDSP_XPU_ESYNR2_QDSP_ADDR A:0x600370d8
y.create.l HWIO_QDSP_XPU_UMR_RACR_QDSP_ADDR A:0x600370e0
y.create.l HWIO_QDSP_XPU_UMR_WACR_QDSP_ADDR A:0x600370e4
y.create.l HWIO_QDSP_XPU_UMR_CNTL_QDSP_ADDR A:0x600370f0
y.create.l HWIO_QDSP_XPU_IDR0_QDSP_ADDR A:0x60037074
y.create.l HWIO_QDSP_XPU_IDR1_QDSP_ADDR A:0x60037078
y.create.l HWIO_QDSP_XPU_REV_QDSP_ADDR A:0x6003707c
y.create.l HWIO_QDSP_XPU_PRT0_RACR0_QDSP_ADDR A:0x60037200
y.create.l HWIO_QDSP_XPU_PRT1_RACR0_QDSP_ADDR A:0x60037280
y.create.l HWIO_QDSP_XPU_PRT2_RACR0_QDSP_ADDR A:0x60037300
y.create.l HWIO_QDSP_XPU_PRT3_RACR0_QDSP_ADDR A:0x60037380
y.create.l HWIO_QDSP_XPU_PRT4_RACR0_QDSP_ADDR A:0x60037400
y.create.l HWIO_QDSP_XPU_PRT5_RACR0_QDSP_ADDR A:0x60037480
y.create.l HWIO_QDSP_XPU_PRT6_RACR0_QDSP_ADDR A:0x60037500
y.create.l HWIO_QDSP_XPU_PRT7_RACR0_QDSP_ADDR A:0x60037580
y.create.l HWIO_QDSP_XPU_PRT8_RACR0_QDSP_ADDR A:0x60037600
y.create.l HWIO_QDSP_XPU_PRT9_RACR0_QDSP_ADDR A:0x60037680
y.create.l HWIO_QDSP_XPU_PRT0_START0_QDSP_ADDR A:0x60037240
y.create.l HWIO_QDSP_XPU_PRT1_START0_QDSP_ADDR A:0x600372c0
y.create.l HWIO_QDSP_XPU_PRT2_START0_QDSP_ADDR A:0x60037340
y.create.l HWIO_QDSP_XPU_PRT3_START0_QDSP_ADDR A:0x600373c0
y.create.l HWIO_QDSP_XPU_PRT4_START0_QDSP_ADDR A:0x60037440
y.create.l HWIO_QDSP_XPU_PRT5_START0_QDSP_ADDR A:0x600374c0
y.create.l HWIO_QDSP_XPU_PRT6_START0_QDSP_ADDR A:0x60037540
y.create.l HWIO_QDSP_XPU_PRT7_START0_QDSP_ADDR A:0x600375c0
y.create.l HWIO_QDSP_XPU_PRT8_START0_QDSP_ADDR A:0x60037640
y.create.l HWIO_QDSP_XPU_PRT9_START0_QDSP_ADDR A:0x600376c0
y.create.l HWIO_QDSP_XPU_PRT0_END0_QDSP_ADDR A:0x60037248
y.create.l HWIO_QDSP_XPU_PRT1_END0_QDSP_ADDR A:0x600372c8
y.create.l HWIO_QDSP_XPU_PRT2_END0_QDSP_ADDR A:0x60037348
y.create.l HWIO_QDSP_XPU_PRT3_END0_QDSP_ADDR A:0x600373c8
y.create.l HWIO_QDSP_XPU_PRT4_END0_QDSP_ADDR A:0x60037448
y.create.l HWIO_QDSP_XPU_PRT5_END0_QDSP_ADDR A:0x600374c8
y.create.l HWIO_QDSP_XPU_PRT6_END0_QDSP_ADDR A:0x60037548
y.create.l HWIO_QDSP_XPU_PRT7_END0_QDSP_ADDR A:0x600375c8
y.create.l HWIO_QDSP_XPU_PRT8_END0_QDSP_ADDR A:0x60037648
y.create.l HWIO_QDSP_XPU_PRT9_END0_QDSP_ADDR A:0x600376c8
y.create.l HWIO_QDSP_XPU_PRT0_SCR_QDSP_ADDR A:0x60037250
y.create.l HWIO_QDSP_XPU_PRT1_SCR_QDSP_ADDR A:0x600372d0
y.create.l HWIO_QDSP_XPU_PRT2_SCR_QDSP_ADDR A:0x60037350
y.create.l HWIO_QDSP_XPU_PRT3_SCR_QDSP_ADDR A:0x600373d0
y.create.l HWIO_QDSP_XPU_PRT4_SCR_QDSP_ADDR A:0x60037450
y.create.l HWIO_QDSP_XPU_PRT5_SCR_QDSP_ADDR A:0x600374d0
y.create.l HWIO_QDSP_XPU_PRT6_SCR_QDSP_ADDR A:0x60037550
y.create.l HWIO_QDSP_XPU_PRT7_SCR_QDSP_ADDR A:0x600375d0
y.create.l HWIO_QDSP_XPU_PRT8_SCR_QDSP_ADDR A:0x60037650
y.create.l HWIO_QDSP_XPU_PRT9_SCR_QDSP_ADDR A:0x600376d0
y.create.l HWIO_QDSP_XPU_PRT0_MCR_QDSP_ADDR A:0x60037254
y.create.l HWIO_QDSP_XPU_PRT1_MCR_QDSP_ADDR A:0x600372d4
y.create.l HWIO_QDSP_XPU_PRT2_MCR_QDSP_ADDR A:0x60037354
y.create.l HWIO_QDSP_XPU_PRT3_MCR_QDSP_ADDR A:0x600373d4
y.create.l HWIO_QDSP_XPU_PRT4_MCR_QDSP_ADDR A:0x60037454
y.create.l HWIO_QDSP_XPU_PRT5_MCR_QDSP_ADDR A:0x600374d4
y.create.l HWIO_QDSP_XPU_PRT6_MCR_QDSP_ADDR A:0x60037554
y.create.l HWIO_QDSP_XPU_PRT7_MCR_QDSP_ADDR A:0x600375d4
y.create.l HWIO_QDSP_XPU_PRT8_MCR_QDSP_ADDR A:0x60037654
y.create.l HWIO_QDSP_XPU_PRT9_MCR_QDSP_ADDR A:0x600376d4
y.create.l HWIO_QDSP_XPU_PRT0_CNTL0_QDSP_ADDR A:0x60037258
y.create.l HWIO_QDSP_XPU_PRT1_CNTL0_QDSP_ADDR A:0x600372d8
y.create.l HWIO_QDSP_XPU_PRT2_CNTL0_QDSP_ADDR A:0x60037358
y.create.l HWIO_QDSP_XPU_PRT3_CNTL0_QDSP_ADDR A:0x600373d8
y.create.l HWIO_QDSP_XPU_PRT4_CNTL0_QDSP_ADDR A:0x60037458
y.create.l HWIO_QDSP_XPU_PRT5_CNTL0_QDSP_ADDR A:0x600374d8
y.create.l HWIO_QDSP_XPU_PRT6_CNTL0_QDSP_ADDR A:0x60037558
y.create.l HWIO_QDSP_XPU_PRT7_CNTL0_QDSP_ADDR A:0x600375d8
y.create.l HWIO_QDSP_XPU_PRT8_CNTL0_QDSP_ADDR A:0x60037658
y.create.l HWIO_QDSP_XPU_PRT9_CNTL0_QDSP_ADDR A:0x600376d8
y.create.l HWIO_QDSP_XPU_PRT0_CNTL1_QDSP_ADDR A:0x6003725c
y.create.l HWIO_QDSP_XPU_PRT1_CNTL1_QDSP_ADDR A:0x600372dc
y.create.l HWIO_QDSP_XPU_PRT2_CNTL1_QDSP_ADDR A:0x6003735c
y.create.l HWIO_QDSP_XPU_PRT3_CNTL1_QDSP_ADDR A:0x600373dc
y.create.l HWIO_QDSP_XPU_PRT4_CNTL1_QDSP_ADDR A:0x6003745c
y.create.l HWIO_QDSP_XPU_PRT5_CNTL1_QDSP_ADDR A:0x600374dc
y.create.l HWIO_QDSP_XPU_PRT6_CNTL1_QDSP_ADDR A:0x6003755c
y.create.l HWIO_QDSP_XPU_PRT7_CNTL1_QDSP_ADDR A:0x600375dc
y.create.l HWIO_QDSP_XPU_PRT8_CNTL1_QDSP_ADDR A:0x6003765c
y.create.l HWIO_QDSP_XPU_PRT9_CNTL1_QDSP_ADDR A:0x600376dc
y.create.l HWIO_APPS_SMMU_SCR0_APPS_ADDR A:0x61e00000
y.create.l HWIO_APPS_SMMU_NSCR0_APPS_ADDR A:0x61e00400
y.create.l HWIO_APPS_SMMU_SCR1_APPS_ADDR A:0x61e00004
y.create.l HWIO_APPS_SMMU_SACR_APPS_ADDR A:0x61e00010
y.create.l HWIO_APPS_SMMU_NSACR_APPS_ADDR A:0x61e00410
y.create.l HWIO_APPS_SMMU_SIDR0_APPS_ADDR A:0x61e00020
y.create.l HWIO_APPS_SMMU_SIDR1_APPS_ADDR A:0x61e00024
y.create.l HWIO_APPS_SMMU_SIDR2_APPS_ADDR A:0x61e00028
y.create.l HWIO_APPS_SMMU_SIDR7_APPS_ADDR A:0x61e0003c
y.create.l HWIO_APPS_SMMU_SGFAR_LOW_APPS_ADDR A:0x61e00040
y.create.l HWIO_APPS_SMMU_SGFAR_HIGH_APPS_ADDR A:0x61e00044
y.create.l HWIO_APPS_SMMU_NSGFAR_LOW_APPS_ADDR A:0x61e00440
y.create.l HWIO_APPS_SMMU_NSGFAR_HIGH_APPS_ADDR A:0x61e00444
y.create.l HWIO_APPS_SMMU_SGFSR_APPS_ADDR A:0x61e00048
y.create.l HWIO_APPS_SMMU_NSGFSR_APPS_ADDR A:0x61e00448
y.create.l HWIO_APPS_SMMU_SGFSRRESTORE_APPS_ADDR A:0x61e0004c
y.create.l HWIO_APPS_SMMU_NSGFSRRESTORE_APPS_ADDR A:0x61e0044c
y.create.l HWIO_APPS_SMMU_SGFSYNR0_APPS_ADDR A:0x61e00050
y.create.l HWIO_APPS_SMMU_NSGFSYNR0_APPS_ADDR A:0x61e00450
y.create.l HWIO_APPS_SMMU_SGFSYNR1_APPS_ADDR A:0x61e00054
y.create.l HWIO_APPS_SMMU_NSGFSYNDR1_APPS_ADDR A:0x61e00454
y.create.l HWIO_APPS_SMMU_STLBIALL_APPS_ADDR A:0x61e00060
y.create.l HWIO_APPS_SMMU_TLBIVMID_APPS_ADDR A:0x61e00064
y.create.l HWIO_APPS_SMMU_TLBIALLNSNH_APPS_ADDR A:0x61e00068
y.create.l HWIO_APPS_SMMU_NSTLBGSYNC_APPS_ADDR A:0x61e00470
y.create.l HWIO_APPS_SMMU_STLBGSYNC_APPS_ADDR A:0x61e00070
y.create.l HWIO_APPS_SMMU_STLBGSTATUS_APPS_ADDR A:0x61e00074
y.create.l HWIO_APPS_SMMU_NSTLBGSTATUS_APPS_ADDR A:0x61e00474
y.create.l HWIO_APPS_SMMU_DBGRPTRTBU_APPS_ADDR A:0x61e00080
y.create.l HWIO_APPS_SMMU_DBGRDATATBU_APPS_ADDR A:0x61e00084
y.create.l HWIO_APPS_SMMU_DBGRPTRTCU_APPS_ADDR A:0x61e00088
y.create.l HWIO_APPS_SMMU_DBGRDATATCU_APPS_ADDR A:0x61e0008c
y.create.l HWIO_APPS_SMMU_STLBIVALM_LOW_APPS_ADDR A:0x61e000a0
y.create.l HWIO_APPS_SMMU_STLBIVALM_HIGH_APPS_ADDR A:0x61e000a4
y.create.l HWIO_APPS_SMMU_STLBIVAM_LOW_APPS_ADDR A:0x61e000a8
y.create.l HWIO_APPS_SMMU_STLBIVAM_HIGH_APPS_ADDR A:0x61e000ac
y.create.l HWIO_APPS_SMMU_STLBIALLM_APPS_ADDR A:0x61e000bc
y.create.l HWIO_APPS_SMMU_SMR0_APPS_ADDR A:0x61e00800
y.create.l HWIO_APPS_SMMU_SMR1_APPS_ADDR A:0x61e00804
y.create.l HWIO_APPS_SMMU_SMR2_APPS_ADDR A:0x61e00808
y.create.l HWIO_APPS_SMMU_SMR3_APPS_ADDR A:0x61e0080c
y.create.l HWIO_APPS_SMMU_SMR4_APPS_ADDR A:0x61e00810
y.create.l HWIO_APPS_SMMU_SMR5_APPS_ADDR A:0x61e00814
y.create.l HWIO_APPS_SMMU_SMR6_APPS_ADDR A:0x61e00818
y.create.l HWIO_APPS_SMMU_SMR7_APPS_ADDR A:0x61e0081c
y.create.l HWIO_APPS_SMMU_SMR8_APPS_ADDR A:0x61e00820
y.create.l HWIO_APPS_SMMU_SMR9_APPS_ADDR A:0x61e00824
y.create.l HWIO_APPS_SMMU_SMR10_APPS_ADDR A:0x61e00828
y.create.l HWIO_APPS_SMMU_SMR11_APPS_ADDR A:0x61e0082c
y.create.l HWIO_APPS_SMMU_SMR12_APPS_ADDR A:0x61e00830
y.create.l HWIO_APPS_SMMU_SMR13_APPS_ADDR A:0x61e00834
y.create.l HWIO_APPS_SMMU_SMR14_APPS_ADDR A:0x61e00838
y.create.l HWIO_APPS_SMMU_SMR15_APPS_ADDR A:0x61e0083c
y.create.l HWIO_APPS_SMMU_SMR16_APPS_ADDR A:0x61e00840
y.create.l HWIO_APPS_SMMU_SMR17_APPS_ADDR A:0x61e00844
y.create.l HWIO_APPS_SMMU_SMR18_APPS_ADDR A:0x61e00848
y.create.l HWIO_APPS_SMMU_SMR19_APPS_ADDR A:0x61e0084c
y.create.l HWIO_APPS_SMMU_SMR20_APPS_ADDR A:0x61e00850
y.create.l HWIO_APPS_SMMU_SMR21_APPS_ADDR A:0x61e00854
y.create.l HWIO_APPS_SMMU_SMR22_APPS_ADDR A:0x61e00858
y.create.l HWIO_APPS_SMMU_SMR23_APPS_ADDR A:0x61e0085c
y.create.l HWIO_APPS_SMMU_SMR24_APPS_ADDR A:0x61e00860
y.create.l HWIO_APPS_SMMU_SMR25_APPS_ADDR A:0x61e00864
y.create.l HWIO_APPS_SMMU_SMR26_APPS_ADDR A:0x61e00868
y.create.l HWIO_APPS_SMMU_SMR27_APPS_ADDR A:0x61e0086c
y.create.l HWIO_APPS_SMMU_SMR28_APPS_ADDR A:0x61e00870
y.create.l HWIO_APPS_SMMU_SMR29_APPS_ADDR A:0x61e00874
y.create.l HWIO_APPS_SMMU_SMR30_APPS_ADDR A:0x61e00878
y.create.l HWIO_APPS_SMMU_SMR31_APPS_ADDR A:0x61e0087c
y.create.l HWIO_APPS_SMMU_SMR32_APPS_ADDR A:0x61e00880
y.create.l HWIO_APPS_SMMU_SMR33_APPS_ADDR A:0x61e00884
y.create.l HWIO_APPS_SMMU_SMR34_APPS_ADDR A:0x61e00888
y.create.l HWIO_APPS_SMMU_SMR35_APPS_ADDR A:0x61e0088c
y.create.l HWIO_APPS_SMMU_SMR36_APPS_ADDR A:0x61e00890
y.create.l HWIO_APPS_SMMU_SMR37_APPS_ADDR A:0x61e00894
y.create.l HWIO_APPS_SMMU_SMR38_APPS_ADDR A:0x61e00898
y.create.l HWIO_APPS_SMMU_SMR39_APPS_ADDR A:0x61e0089c
y.create.l HWIO_APPS_SMMU_SMR40_APPS_ADDR A:0x61e008a0
y.create.l HWIO_APPS_SMMU_SMR41_APPS_ADDR A:0x61e008a4
y.create.l HWIO_APPS_SMMU_SMR42_APPS_ADDR A:0x61e008a8
y.create.l HWIO_APPS_SMMU_SMR43_APPS_ADDR A:0x61e008ac
y.create.l HWIO_APPS_SMMU_SMR44_APPS_ADDR A:0x61e008b0
y.create.l HWIO_APPS_SMMU_SMR45_APPS_ADDR A:0x61e008b4
y.create.l HWIO_APPS_SMMU_SMR46_APPS_ADDR A:0x61e008b8
y.create.l HWIO_APPS_SMMU_SMR47_APPS_ADDR A:0x61e008bc
y.create.l HWIO_APPS_SMMU_SMR48_APPS_ADDR A:0x61e008c0
y.create.l HWIO_APPS_SMMU_SMR49_APPS_ADDR A:0x61e008c4
y.create.l HWIO_APPS_SMMU_SMR50_APPS_ADDR A:0x61e008c8
y.create.l HWIO_APPS_SMMU_SMR51_APPS_ADDR A:0x61e008cc
y.create.l HWIO_APPS_SMMU_SMR52_APPS_ADDR A:0x61e008d0
y.create.l HWIO_APPS_SMMU_SMR53_APPS_ADDR A:0x61e008d4
y.create.l HWIO_APPS_SMMU_SMR54_APPS_ADDR A:0x61e008d8
y.create.l HWIO_APPS_SMMU_SMR55_APPS_ADDR A:0x61e008dc
y.create.l HWIO_APPS_SMMU_SMR56_APPS_ADDR A:0x61e008e0
y.create.l HWIO_APPS_SMMU_SMR57_APPS_ADDR A:0x61e008e4
y.create.l HWIO_APPS_SMMU_SMR58_APPS_ADDR A:0x61e008e8
y.create.l HWIO_APPS_SMMU_SMR59_APPS_ADDR A:0x61e008ec
y.create.l HWIO_APPS_SMMU_SMR60_APPS_ADDR A:0x61e008f0
y.create.l HWIO_APPS_SMMU_SMR61_APPS_ADDR A:0x61e008f4
y.create.l HWIO_APPS_SMMU_SMR62_APPS_ADDR A:0x61e008f8
y.create.l HWIO_APPS_SMMU_SMR63_APPS_ADDR A:0x61e008fc
y.create.l HWIO_APPS_SMMU_SMR64_APPS_ADDR A:0x61e00900
y.create.l HWIO_APPS_SMMU_SMR65_APPS_ADDR A:0x61e00904
y.create.l HWIO_APPS_SMMU_SMR66_APPS_ADDR A:0x61e00908
y.create.l HWIO_APPS_SMMU_SMR67_APPS_ADDR A:0x61e0090c
y.create.l HWIO_APPS_SMMU_SMR68_APPS_ADDR A:0x61e00910
y.create.l HWIO_APPS_SMMU_SMR69_APPS_ADDR A:0x61e00914
y.create.l HWIO_APPS_SMMU_SMR70_APPS_ADDR A:0x61e00918
y.create.l HWIO_APPS_SMMU_SMR71_APPS_ADDR A:0x61e0091c
y.create.l HWIO_APPS_SMMU_SMR72_APPS_ADDR A:0x61e00920
y.create.l HWIO_APPS_SMMU_SMR73_APPS_ADDR A:0x61e00924
y.create.l HWIO_APPS_SMMU_SMR74_APPS_ADDR A:0x61e00928
y.create.l HWIO_APPS_SMMU_SMR75_APPS_ADDR A:0x61e0092c
y.create.l HWIO_APPS_SMMU_SMR76_APPS_ADDR A:0x61e00930
y.create.l HWIO_APPS_SMMU_SMR77_APPS_ADDR A:0x61e00934
y.create.l HWIO_APPS_SMMU_SMR78_APPS_ADDR A:0x61e00938
y.create.l HWIO_APPS_SMMU_SMR79_APPS_ADDR A:0x61e0093c
y.create.l HWIO_APPS_SMMU_SMR80_APPS_ADDR A:0x61e00940
y.create.l HWIO_APPS_SMMU_SMR81_APPS_ADDR A:0x61e00944
y.create.l HWIO_APPS_SMMU_SMR82_APPS_ADDR A:0x61e00948
y.create.l HWIO_APPS_SMMU_SMR83_APPS_ADDR A:0x61e0094c
y.create.l HWIO_APPS_SMMU_SMR84_APPS_ADDR A:0x61e00950
y.create.l HWIO_APPS_SMMU_SMR85_APPS_ADDR A:0x61e00954
y.create.l HWIO_APPS_SMMU_SMR86_APPS_ADDR A:0x61e00958
y.create.l HWIO_APPS_SMMU_SMR87_APPS_ADDR A:0x61e0095c
y.create.l HWIO_APPS_SMMU_SMR88_APPS_ADDR A:0x61e00960
y.create.l HWIO_APPS_SMMU_SMR89_APPS_ADDR A:0x61e00964
y.create.l HWIO_APPS_SMMU_SMR90_APPS_ADDR A:0x61e00968
y.create.l HWIO_APPS_SMMU_SMR91_APPS_ADDR A:0x61e0096c
y.create.l HWIO_APPS_SMMU_SMR92_APPS_ADDR A:0x61e00970
y.create.l HWIO_APPS_SMMU_SMR93_APPS_ADDR A:0x61e00974
y.create.l HWIO_APPS_SMMU_SMR94_APPS_ADDR A:0x61e00978
y.create.l HWIO_APPS_SMMU_SMR95_APPS_ADDR A:0x61e0097c
y.create.l HWIO_APPS_SMMU_SMR96_APPS_ADDR A:0x61e00980
y.create.l HWIO_APPS_SMMU_SMR97_APPS_ADDR A:0x61e00984
y.create.l HWIO_APPS_SMMU_SMR98_APPS_ADDR A:0x61e00988
y.create.l HWIO_APPS_SMMU_SMR99_APPS_ADDR A:0x61e0098c
y.create.l HWIO_APPS_SMMU_SMR100_APPS_ADDR A:0x61e00990
y.create.l HWIO_APPS_SMMU_SMR101_APPS_ADDR A:0x61e00994
y.create.l HWIO_APPS_SMMU_SMR102_APPS_ADDR A:0x61e00998
y.create.l HWIO_APPS_SMMU_SMR103_APPS_ADDR A:0x61e0099c
y.create.l HWIO_APPS_SMMU_SMR104_APPS_ADDR A:0x61e009a0
y.create.l HWIO_APPS_SMMU_SMR105_APPS_ADDR A:0x61e009a4
y.create.l HWIO_APPS_SMMU_SMR106_APPS_ADDR A:0x61e009a8
y.create.l HWIO_APPS_SMMU_SMR107_APPS_ADDR A:0x61e009ac
y.create.l HWIO_APPS_SMMU_SMR108_APPS_ADDR A:0x61e009b0
y.create.l HWIO_APPS_SMMU_SMR109_APPS_ADDR A:0x61e009b4
y.create.l HWIO_APPS_SMMU_SMR110_APPS_ADDR A:0x61e009b8
y.create.l HWIO_APPS_SMMU_SMR111_APPS_ADDR A:0x61e009bc
y.create.l HWIO_APPS_SMMU_SMR112_APPS_ADDR A:0x61e009c0
y.create.l HWIO_APPS_SMMU_SMR113_APPS_ADDR A:0x61e009c4
y.create.l HWIO_APPS_SMMU_SMR114_APPS_ADDR A:0x61e009c8
y.create.l HWIO_APPS_SMMU_SMR115_APPS_ADDR A:0x61e009cc
y.create.l HWIO_APPS_SMMU_SMR116_APPS_ADDR A:0x61e009d0
y.create.l HWIO_APPS_SMMU_SMR117_APPS_ADDR A:0x61e009d4
y.create.l HWIO_APPS_SMMU_SMR118_APPS_ADDR A:0x61e009d8
y.create.l HWIO_APPS_SMMU_SMR119_APPS_ADDR A:0x61e009dc
y.create.l HWIO_APPS_SMMU_SMR120_APPS_ADDR A:0x61e009e0
y.create.l HWIO_APPS_SMMU_SMR121_APPS_ADDR A:0x61e009e4
y.create.l HWIO_APPS_SMMU_SMR122_APPS_ADDR A:0x61e009e8
y.create.l HWIO_APPS_SMMU_SMR123_APPS_ADDR A:0x61e009ec
y.create.l HWIO_APPS_SMMU_SMR124_APPS_ADDR A:0x61e009f0
y.create.l HWIO_APPS_SMMU_SMR125_APPS_ADDR A:0x61e009f4
y.create.l HWIO_APPS_SMMU_SMR126_APPS_ADDR A:0x61e009f8
y.create.l HWIO_APPS_SMMU_SMR127_APPS_ADDR A:0x61e009fc
y.create.l HWIO_APPS_SMMU_S2CR0_APPS_ADDR A:0x61e00c00
y.create.l HWIO_APPS_SMMU_S2CR1_APPS_ADDR A:0x61e00c04
y.create.l HWIO_APPS_SMMU_S2CR2_APPS_ADDR A:0x61e00c08
y.create.l HWIO_APPS_SMMU_S2CR3_APPS_ADDR A:0x61e00c0c
y.create.l HWIO_APPS_SMMU_S2CR4_APPS_ADDR A:0x61e00c10
y.create.l HWIO_APPS_SMMU_S2CR5_APPS_ADDR A:0x61e00c14
y.create.l HWIO_APPS_SMMU_S2CR6_APPS_ADDR A:0x61e00c18
y.create.l HWIO_APPS_SMMU_S2CR7_APPS_ADDR A:0x61e00c1c
y.create.l HWIO_APPS_SMMU_S2CR8_APPS_ADDR A:0x61e00c20
y.create.l HWIO_APPS_SMMU_S2CR9_APPS_ADDR A:0x61e00c24
y.create.l HWIO_APPS_SMMU_S2CR10_APPS_ADDR A:0x61e00c28
y.create.l HWIO_APPS_SMMU_S2CR11_APPS_ADDR A:0x61e00c2c
y.create.l HWIO_APPS_SMMU_S2CR12_APPS_ADDR A:0x61e00c30
y.create.l HWIO_APPS_SMMU_S2CR13_APPS_ADDR A:0x61e00c34
y.create.l HWIO_APPS_SMMU_S2CR14_APPS_ADDR A:0x61e00c38
y.create.l HWIO_APPS_SMMU_S2CR15_APPS_ADDR A:0x61e00c3c
y.create.l HWIO_APPS_SMMU_S2CR16_APPS_ADDR A:0x61e00c40
y.create.l HWIO_APPS_SMMU_S2CR17_APPS_ADDR A:0x61e00c44
y.create.l HWIO_APPS_SMMU_S2CR18_APPS_ADDR A:0x61e00c48
y.create.l HWIO_APPS_SMMU_S2CR19_APPS_ADDR A:0x61e00c4c
y.create.l HWIO_APPS_SMMU_S2CR20_APPS_ADDR A:0x61e00c50
y.create.l HWIO_APPS_SMMU_S2CR21_APPS_ADDR A:0x61e00c54
y.create.l HWIO_APPS_SMMU_S2CR22_APPS_ADDR A:0x61e00c58
y.create.l HWIO_APPS_SMMU_S2CR23_APPS_ADDR A:0x61e00c5c
y.create.l HWIO_APPS_SMMU_S2CR24_APPS_ADDR A:0x61e00c60
y.create.l HWIO_APPS_SMMU_S2CR25_APPS_ADDR A:0x61e00c64
y.create.l HWIO_APPS_SMMU_S2CR26_APPS_ADDR A:0x61e00c68
y.create.l HWIO_APPS_SMMU_S2CR27_APPS_ADDR A:0x61e00c6c
y.create.l HWIO_APPS_SMMU_S2CR28_APPS_ADDR A:0x61e00c70
y.create.l HWIO_APPS_SMMU_S2CR29_APPS_ADDR A:0x61e00c74
y.create.l HWIO_APPS_SMMU_S2CR30_APPS_ADDR A:0x61e00c78
y.create.l HWIO_APPS_SMMU_S2CR31_APPS_ADDR A:0x61e00c7c
y.create.l HWIO_APPS_SMMU_S2CR32_APPS_ADDR A:0x61e00c80
y.create.l HWIO_APPS_SMMU_S2CR33_APPS_ADDR A:0x61e00c84
y.create.l HWIO_APPS_SMMU_S2CR34_APPS_ADDR A:0x61e00c88
y.create.l HWIO_APPS_SMMU_S2CR35_APPS_ADDR A:0x61e00c8c
y.create.l HWIO_APPS_SMMU_S2CR36_APPS_ADDR A:0x61e00c90
y.create.l HWIO_APPS_SMMU_S2CR37_APPS_ADDR A:0x61e00c94
y.create.l HWIO_APPS_SMMU_S2CR38_APPS_ADDR A:0x61e00c98
y.create.l HWIO_APPS_SMMU_S2CR39_APPS_ADDR A:0x61e00c9c
y.create.l HWIO_APPS_SMMU_S2CR40_APPS_ADDR A:0x61e00ca0
y.create.l HWIO_APPS_SMMU_S2CR41_APPS_ADDR A:0x61e00ca4
y.create.l HWIO_APPS_SMMU_S2CR42_APPS_ADDR A:0x61e00ca8
y.create.l HWIO_APPS_SMMU_S2CR43_APPS_ADDR A:0x61e00cac
y.create.l HWIO_APPS_SMMU_S2CR44_APPS_ADDR A:0x61e00cb0
y.create.l HWIO_APPS_SMMU_S2CR45_APPS_ADDR A:0x61e00cb4
y.create.l HWIO_APPS_SMMU_S2CR46_APPS_ADDR A:0x61e00cb8
y.create.l HWIO_APPS_SMMU_S2CR47_APPS_ADDR A:0x61e00cbc
y.create.l HWIO_APPS_SMMU_S2CR48_APPS_ADDR A:0x61e00cc0
y.create.l HWIO_APPS_SMMU_S2CR49_APPS_ADDR A:0x61e00cc4
y.create.l HWIO_APPS_SMMU_S2CR50_APPS_ADDR A:0x61e00cc8
y.create.l HWIO_APPS_SMMU_S2CR51_APPS_ADDR A:0x61e00ccc
y.create.l HWIO_APPS_SMMU_S2CR52_APPS_ADDR A:0x61e00cd0
y.create.l HWIO_APPS_SMMU_S2CR53_APPS_ADDR A:0x61e00cd4
y.create.l HWIO_APPS_SMMU_S2CR54_APPS_ADDR A:0x61e00cd8
y.create.l HWIO_APPS_SMMU_S2CR55_APPS_ADDR A:0x61e00cdc
y.create.l HWIO_APPS_SMMU_S2CR56_APPS_ADDR A:0x61e00ce0
y.create.l HWIO_APPS_SMMU_S2CR57_APPS_ADDR A:0x61e00ce4
y.create.l HWIO_APPS_SMMU_S2CR58_APPS_ADDR A:0x61e00ce8
y.create.l HWIO_APPS_SMMU_S2CR59_APPS_ADDR A:0x61e00cec
y.create.l HWIO_APPS_SMMU_S2CR60_APPS_ADDR A:0x61e00cf0
y.create.l HWIO_APPS_SMMU_S2CR61_APPS_ADDR A:0x61e00cf4
y.create.l HWIO_APPS_SMMU_S2CR62_APPS_ADDR A:0x61e00cf8
y.create.l HWIO_APPS_SMMU_S2CR63_APPS_ADDR A:0x61e00cfc
y.create.l HWIO_APPS_SMMU_S2CR64_APPS_ADDR A:0x61e00d00
y.create.l HWIO_APPS_SMMU_S2CR65_APPS_ADDR A:0x61e00d04
y.create.l HWIO_APPS_SMMU_S2CR66_APPS_ADDR A:0x61e00d08
y.create.l HWIO_APPS_SMMU_S2CR67_APPS_ADDR A:0x61e00d0c
y.create.l HWIO_APPS_SMMU_S2CR68_APPS_ADDR A:0x61e00d10
y.create.l HWIO_APPS_SMMU_S2CR69_APPS_ADDR A:0x61e00d14
y.create.l HWIO_APPS_SMMU_S2CR70_APPS_ADDR A:0x61e00d18
y.create.l HWIO_APPS_SMMU_S2CR71_APPS_ADDR A:0x61e00d1c
y.create.l HWIO_APPS_SMMU_S2CR72_APPS_ADDR A:0x61e00d20
y.create.l HWIO_APPS_SMMU_S2CR73_APPS_ADDR A:0x61e00d24
y.create.l HWIO_APPS_SMMU_S2CR74_APPS_ADDR A:0x61e00d28
y.create.l HWIO_APPS_SMMU_S2CR75_APPS_ADDR A:0x61e00d2c
y.create.l HWIO_APPS_SMMU_S2CR76_APPS_ADDR A:0x61e00d30
y.create.l HWIO_APPS_SMMU_S2CR77_APPS_ADDR A:0x61e00d34
y.create.l HWIO_APPS_SMMU_S2CR78_APPS_ADDR A:0x61e00d38
y.create.l HWIO_APPS_SMMU_S2CR79_APPS_ADDR A:0x61e00d3c
y.create.l HWIO_APPS_SMMU_S2CR80_APPS_ADDR A:0x61e00d40
y.create.l HWIO_APPS_SMMU_S2CR81_APPS_ADDR A:0x61e00d44
y.create.l HWIO_APPS_SMMU_S2CR82_APPS_ADDR A:0x61e00d48
y.create.l HWIO_APPS_SMMU_S2CR83_APPS_ADDR A:0x61e00d4c
y.create.l HWIO_APPS_SMMU_S2CR84_APPS_ADDR A:0x61e00d50
y.create.l HWIO_APPS_SMMU_S2CR85_APPS_ADDR A:0x61e00d54
y.create.l HWIO_APPS_SMMU_S2CR86_APPS_ADDR A:0x61e00d58
y.create.l HWIO_APPS_SMMU_S2CR87_APPS_ADDR A:0x61e00d5c
y.create.l HWIO_APPS_SMMU_S2CR88_APPS_ADDR A:0x61e00d60
y.create.l HWIO_APPS_SMMU_S2CR89_APPS_ADDR A:0x61e00d64
y.create.l HWIO_APPS_SMMU_S2CR90_APPS_ADDR A:0x61e00d68
y.create.l HWIO_APPS_SMMU_S2CR91_APPS_ADDR A:0x61e00d6c
y.create.l HWIO_APPS_SMMU_S2CR92_APPS_ADDR A:0x61e00d70
y.create.l HWIO_APPS_SMMU_S2CR93_APPS_ADDR A:0x61e00d74
y.create.l HWIO_APPS_SMMU_S2CR94_APPS_ADDR A:0x61e00d78
y.create.l HWIO_APPS_SMMU_S2CR95_APPS_ADDR A:0x61e00d7c
y.create.l HWIO_APPS_SMMU_S2CR96_APPS_ADDR A:0x61e00d80
y.create.l HWIO_APPS_SMMU_S2CR97_APPS_ADDR A:0x61e00d84
y.create.l HWIO_APPS_SMMU_S2CR98_APPS_ADDR A:0x61e00d88
y.create.l HWIO_APPS_SMMU_S2CR99_APPS_ADDR A:0x61e00d8c
y.create.l HWIO_APPS_SMMU_S2CR100_APPS_ADDR A:0x61e00d90
y.create.l HWIO_APPS_SMMU_S2CR101_APPS_ADDR A:0x61e00d94
y.create.l HWIO_APPS_SMMU_S2CR102_APPS_ADDR A:0x61e00d98
y.create.l HWIO_APPS_SMMU_S2CR103_APPS_ADDR A:0x61e00d9c
y.create.l HWIO_APPS_SMMU_S2CR104_APPS_ADDR A:0x61e00da0
y.create.l HWIO_APPS_SMMU_S2CR105_APPS_ADDR A:0x61e00da4
y.create.l HWIO_APPS_SMMU_S2CR106_APPS_ADDR A:0x61e00da8
y.create.l HWIO_APPS_SMMU_S2CR107_APPS_ADDR A:0x61e00dac
y.create.l HWIO_APPS_SMMU_S2CR108_APPS_ADDR A:0x61e00db0
y.create.l HWIO_APPS_SMMU_S2CR109_APPS_ADDR A:0x61e00db4
y.create.l HWIO_APPS_SMMU_S2CR110_APPS_ADDR A:0x61e00db8
y.create.l HWIO_APPS_SMMU_S2CR111_APPS_ADDR A:0x61e00dbc
y.create.l HWIO_APPS_SMMU_S2CR112_APPS_ADDR A:0x61e00dc0
y.create.l HWIO_APPS_SMMU_S2CR113_APPS_ADDR A:0x61e00dc4
y.create.l HWIO_APPS_SMMU_S2CR114_APPS_ADDR A:0x61e00dc8
y.create.l HWIO_APPS_SMMU_S2CR115_APPS_ADDR A:0x61e00dcc
y.create.l HWIO_APPS_SMMU_S2CR116_APPS_ADDR A:0x61e00dd0
y.create.l HWIO_APPS_SMMU_S2CR117_APPS_ADDR A:0x61e00dd4
y.create.l HWIO_APPS_SMMU_S2CR118_APPS_ADDR A:0x61e00dd8
y.create.l HWIO_APPS_SMMU_S2CR119_APPS_ADDR A:0x61e00ddc
y.create.l HWIO_APPS_SMMU_S2CR120_APPS_ADDR A:0x61e00de0
y.create.l HWIO_APPS_SMMU_S2CR121_APPS_ADDR A:0x61e00de4
y.create.l HWIO_APPS_SMMU_S2CR122_APPS_ADDR A:0x61e00de8
y.create.l HWIO_APPS_SMMU_S2CR123_APPS_ADDR A:0x61e00dec
y.create.l HWIO_APPS_SMMU_S2CR124_APPS_ADDR A:0x61e00df0
y.create.l HWIO_APPS_SMMU_S2CR125_APPS_ADDR A:0x61e00df4
y.create.l HWIO_APPS_SMMU_S2CR126_APPS_ADDR A:0x61e00df8
y.create.l HWIO_APPS_SMMU_S2CR127_APPS_ADDR A:0x61e00dfc
y.create.l HWIO_APPS_SMMU_PIDR0_APPS_ADDR A:0x61e00fe0
y.create.l HWIO_APPS_SMMU_PIDR1_APPS_ADDR A:0x61e00fe4
y.create.l HWIO_APPS_SMMU_PIDR2_APPS_ADDR A:0x61e00fe8
y.create.l HWIO_APPS_SMMU_PIDR3_APPS_ADDR A:0x61e00fec
y.create.l HWIO_APPS_SMMU_PIDR4_APPS_ADDR A:0x61e00fd0
y.create.l HWIO_APPS_SMMU_PIDR5_APPS_ADDR A:0x61e00fd4
y.create.l HWIO_APPS_SMMU_PIDR6_APPS_ADDR A:0x61e00fd8
y.create.l HWIO_APPS_SMMU_PIDR7_APPS_ADDR A:0x61e00fdc
y.create.l HWIO_APPS_SMMU_CIDR0_APPS_ADDR A:0x61e00ff0
y.create.l HWIO_APPS_SMMU_CIDR1_APPS_ADDR A:0x61e00ff4
y.create.l HWIO_APPS_SMMU_CIDR2_APPS_ADDR A:0x61e00ff8
y.create.l HWIO_APPS_SMMU_CIDR3_APPS_ADDR A:0x61e00ffc
y.create.l HWIO_APPS_SMMU_CBAR0_APPS_ADDR A:0x61e01000
y.create.l HWIO_APPS_SMMU_CBFRSYNRA0_APPS_ADDR A:0x61e01400
y.create.l HWIO_APPS_SMMU_CBA2R0_APPS_ADDR A:0x61e01800
y.create.l HWIO_APPS_SMMU_CBAR1_APPS_ADDR A:0x61e01004
y.create.l HWIO_APPS_SMMU_CBFRSYNRA1_APPS_ADDR A:0x61e01404
y.create.l HWIO_APPS_SMMU_CBA2R1_APPS_ADDR A:0x61e01804
y.create.l HWIO_APPS_SMMU_CBAR2_APPS_ADDR A:0x61e01008
y.create.l HWIO_APPS_SMMU_CBFRSYNRA2_APPS_ADDR A:0x61e01408
y.create.l HWIO_APPS_SMMU_CBA2R2_APPS_ADDR A:0x61e01808
y.create.l HWIO_APPS_SMMU_CBAR3_APPS_ADDR A:0x61e0100c
y.create.l HWIO_APPS_SMMU_CBFRSYNRA3_APPS_ADDR A:0x61e0140c
y.create.l HWIO_APPS_SMMU_CBA2R3_APPS_ADDR A:0x61e0180c
y.create.l HWIO_APPS_SMMU_CBAR4_APPS_ADDR A:0x61e01010
y.create.l HWIO_APPS_SMMU_CBFRSYNRA4_APPS_ADDR A:0x61e01410
y.create.l HWIO_APPS_SMMU_CBA2R4_APPS_ADDR A:0x61e01810
y.create.l HWIO_APPS_SMMU_CBAR5_APPS_ADDR A:0x61e01014
y.create.l HWIO_APPS_SMMU_CBFRSYNRA5_APPS_ADDR A:0x61e01414
y.create.l HWIO_APPS_SMMU_CBA2R5_APPS_ADDR A:0x61e01814
y.create.l HWIO_APPS_SMMU_CBAR6_APPS_ADDR A:0x61e01018
y.create.l HWIO_APPS_SMMU_CBFRSYNRA6_APPS_ADDR A:0x61e01418
y.create.l HWIO_APPS_SMMU_CBA2R6_APPS_ADDR A:0x61e01818
y.create.l HWIO_APPS_SMMU_CBAR7_APPS_ADDR A:0x61e0101c
y.create.l HWIO_APPS_SMMU_CBFRSYNRA7_APPS_ADDR A:0x61e0141c
y.create.l HWIO_APPS_SMMU_CBA2R7_APPS_ADDR A:0x61e0181c
y.create.l HWIO_APPS_SMMU_CBAR8_APPS_ADDR A:0x61e01020
y.create.l HWIO_APPS_SMMU_CBFRSYNRA8_APPS_ADDR A:0x61e01420
y.create.l HWIO_APPS_SMMU_CBA2R8_APPS_ADDR A:0x61e01820
y.create.l HWIO_APPS_SMMU_CBAR9_APPS_ADDR A:0x61e01024
y.create.l HWIO_APPS_SMMU_CBFRSYNRA9_APPS_ADDR A:0x61e01424
y.create.l HWIO_APPS_SMMU_CBA2R9_APPS_ADDR A:0x61e01824
y.create.l HWIO_APPS_SMMU_CBAR10_APPS_ADDR A:0x61e01028
y.create.l HWIO_APPS_SMMU_CBFRSYNRA10_APPS_ADDR A:0x61e01428
y.create.l HWIO_APPS_SMMU_CBA2R10_APPS_ADDR A:0x61e01828
y.create.l HWIO_APPS_SMMU_CBAR11_APPS_ADDR A:0x61e0102c
y.create.l HWIO_APPS_SMMU_CBFRSYNRA11_APPS_ADDR A:0x61e0142c
y.create.l HWIO_APPS_SMMU_CBA2R11_APPS_ADDR A:0x61e0182c
y.create.l HWIO_APPS_SMMU_CBAR12_APPS_ADDR A:0x61e01030
y.create.l HWIO_APPS_SMMU_CBFRSYNRA12_APPS_ADDR A:0x61e01430
y.create.l HWIO_APPS_SMMU_CBA2R12_APPS_ADDR A:0x61e01830
y.create.l HWIO_APPS_SMMU_CBAR13_APPS_ADDR A:0x61e01034
y.create.l HWIO_APPS_SMMU_CBFRSYNRA13_APPS_ADDR A:0x61e01434
y.create.l HWIO_APPS_SMMU_CBA2R13_APPS_ADDR A:0x61e01834
y.create.l HWIO_APPS_SMMU_CBAR14_APPS_ADDR A:0x61e01038
y.create.l HWIO_APPS_SMMU_CBFRSYNRA14_APPS_ADDR A:0x61e01438
y.create.l HWIO_APPS_SMMU_CBA2R14_APPS_ADDR A:0x61e01838
y.create.l HWIO_APPS_SMMU_CBAR15_APPS_ADDR A:0x61e0103c
y.create.l HWIO_APPS_SMMU_CBFRSYNRA15_APPS_ADDR A:0x61e0143c
y.create.l HWIO_APPS_SMMU_CBA2R15_APPS_ADDR A:0x61e0183c
y.create.l HWIO_APPS_SMMU_CBAR16_APPS_ADDR A:0x61e01040
y.create.l HWIO_APPS_SMMU_CBFRSYNRA16_APPS_ADDR A:0x61e01440
y.create.l HWIO_APPS_SMMU_CBA2R16_APPS_ADDR A:0x61e01840
y.create.l HWIO_APPS_SMMU_CBAR17_APPS_ADDR A:0x61e01044
y.create.l HWIO_APPS_SMMU_CBFRSYNRA17_APPS_ADDR A:0x61e01444
y.create.l HWIO_APPS_SMMU_CBA2R17_APPS_ADDR A:0x61e01844
y.create.l HWIO_APPS_SMMU_CBAR18_APPS_ADDR A:0x61e01048
y.create.l HWIO_APPS_SMMU_CBFRSYNRA18_APPS_ADDR A:0x61e01448
y.create.l HWIO_APPS_SMMU_CBA2R18_APPS_ADDR A:0x61e01848
y.create.l HWIO_APPS_SMMU_CBAR19_APPS_ADDR A:0x61e0104c
y.create.l HWIO_APPS_SMMU_CBFRSYNRA19_APPS_ADDR A:0x61e0144c
y.create.l HWIO_APPS_SMMU_CBA2R19_APPS_ADDR A:0x61e0184c
y.create.l HWIO_APPS_SMMU_CBAR20_APPS_ADDR A:0x61e01050
y.create.l HWIO_APPS_SMMU_CBFRSYNRA20_APPS_ADDR A:0x61e01450
y.create.l HWIO_APPS_SMMU_CBA2R20_APPS_ADDR A:0x61e01850
y.create.l HWIO_APPS_SMMU_CBAR21_APPS_ADDR A:0x61e01054
y.create.l HWIO_APPS_SMMU_CBFRSYNRA21_APPS_ADDR A:0x61e01454
y.create.l HWIO_APPS_SMMU_CBA2R21_APPS_ADDR A:0x61e01854
y.create.l HWIO_APPS_SMMU_CBAR22_APPS_ADDR A:0x61e01058
y.create.l HWIO_APPS_SMMU_CBFRSYNRA22_APPS_ADDR A:0x61e01458
y.create.l HWIO_APPS_SMMU_CBA2R22_APPS_ADDR A:0x61e01858
y.create.l HWIO_APPS_SMMU_CBAR23_APPS_ADDR A:0x61e0105c
y.create.l HWIO_APPS_SMMU_CBFRSYNRA23_APPS_ADDR A:0x61e0145c
y.create.l HWIO_APPS_SMMU_CBA2R23_APPS_ADDR A:0x61e0185c
y.create.l HWIO_APPS_SMMU_CBAR24_APPS_ADDR A:0x61e01060
y.create.l HWIO_APPS_SMMU_CBFRSYNRA24_APPS_ADDR A:0x61e01460
y.create.l HWIO_APPS_SMMU_CBA2R24_APPS_ADDR A:0x61e01860
y.create.l HWIO_APPS_SMMU_CBAR25_APPS_ADDR A:0x61e01064
y.create.l HWIO_APPS_SMMU_CBFRSYNRA25_APPS_ADDR A:0x61e01464
y.create.l HWIO_APPS_SMMU_CBA2R25_APPS_ADDR A:0x61e01864
y.create.l HWIO_APPS_SMMU_CBAR26_APPS_ADDR A:0x61e01068
y.create.l HWIO_APPS_SMMU_CBFRSYNRA26_APPS_ADDR A:0x61e01468
y.create.l HWIO_APPS_SMMU_CBA2R26_APPS_ADDR A:0x61e01868
y.create.l HWIO_APPS_SMMU_CBAR27_APPS_ADDR A:0x61e0106c
y.create.l HWIO_APPS_SMMU_CBFRSYNRA27_APPS_ADDR A:0x61e0146c
y.create.l HWIO_APPS_SMMU_CBA2R27_APPS_ADDR A:0x61e0186c
y.create.l HWIO_APPS_SMMU_CBAR28_APPS_ADDR A:0x61e01070
y.create.l HWIO_APPS_SMMU_CBFRSYNRA28_APPS_ADDR A:0x61e01470
y.create.l HWIO_APPS_SMMU_CBA2R28_APPS_ADDR A:0x61e01870
y.create.l HWIO_APPS_SMMU_CBAR29_APPS_ADDR A:0x61e01074
y.create.l HWIO_APPS_SMMU_CBFRSYNRA29_APPS_ADDR A:0x61e01474
y.create.l HWIO_APPS_SMMU_CBA2R29_APPS_ADDR A:0x61e01874
y.create.l HWIO_APPS_SMMU_CBAR30_APPS_ADDR A:0x61e01078
y.create.l HWIO_APPS_SMMU_CBFRSYNRA30_APPS_ADDR A:0x61e01478
y.create.l HWIO_APPS_SMMU_CBA2R30_APPS_ADDR A:0x61e01878
y.create.l HWIO_APPS_SMMU_CBAR31_APPS_ADDR A:0x61e0107c
y.create.l HWIO_APPS_SMMU_CBFRSYNRA31_APPS_ADDR A:0x61e0147c
y.create.l HWIO_APPS_SMMU_CBA2R31_APPS_ADDR A:0x61e0187c
y.create.l HWIO_APPS_SMMU_ITCTRL_APPS_ADDR A:0x61e02000
y.create.l HWIO_APPS_SMMU_ITIP_APPS_ADDR A:0x61e02004
y.create.l HWIO_APPS_SMMU_ITOP_GLBL_APPS_ADDR A:0x61e02008
y.create.l HWIO_APPS_SMMU_ITOP_PERF_INDEX_APPS_ADDR A:0x61e0200c
y.create.l HWIO_APPS_SMMU_ITOP_CXT0TO31_RAM0_APPS_ADDR A:0x61e02010
y.create.l HWIO_APPS_SMMU_TBUQOS0_APPS_ADDR A:0x61e02100
y.create.l HWIO_APPS_SMMU_PER_APPS_ADDR A:0x61e02200
y.create.l HWIO_APPS_SMMU_TBU_PWR_STATUS_APPS_ADDR A:0x61e02204
y.create.l HWIO_APPS_PMEVCNTR0_APPS_ADDR A:0x61e03000
y.create.l HWIO_APPS_PMEVCNTR1_APPS_ADDR A:0x61e03004
y.create.l HWIO_APPS_PMEVCNTR2_APPS_ADDR A:0x61e03008
y.create.l HWIO_APPS_PMEVCNTR3_APPS_ADDR A:0x61e0300c
y.create.l HWIO_APPS_PMEVTYPER0_APPS_ADDR A:0x61e03400
y.create.l HWIO_APPS_PMEVTYPER1_APPS_ADDR A:0x61e03404
y.create.l HWIO_APPS_PMEVTYPER2_APPS_ADDR A:0x61e03408
y.create.l HWIO_APPS_PMEVTYPER3_APPS_ADDR A:0x61e0340c
y.create.l HWIO_APPS_PMCGCR_APPS_ADDR A:0x61e03800
y.create.l HWIO_APPS_PMCGSMR_APPS_ADDR A:0x61e03a00
y.create.l HWIO_APPS_PMCNTENSET_APPS_ADDR A:0x61e03c00
y.create.l HWIO_APPS_PMCNTENCLR_APPS_ADDR A:0x61e03c20
y.create.l HWIO_APPS_PMINTENSET_APPS_ADDR A:0x61e03c40
y.create.l HWIO_APPS_PMINTENCLR_APPS_ADDR A:0x61e03c60
y.create.l HWIO_APPS_PMOVSCLR_APPS_ADDR A:0x61e03c80
y.create.l HWIO_APPS_PMOVSSET_APPS_ADDR A:0x61e03cc0
y.create.l HWIO_APPS_PMCFGR_APPS_ADDR A:0x61e03e00
y.create.l HWIO_APPS_PMCR_APPS_ADDR A:0x61e03e04
y.create.l HWIO_APPS_PMCEID0_APPS_ADDR A:0x61e03e20
y.create.l HWIO_APPS_PMAUTHSTATUS_APPS_ADDR A:0x61e03fb8
y.create.l HWIO_APPS_PMDEVTYPE_APPS_ADDR A:0x61e03fcc
y.create.l HWIO_APPS_SMMU_SSD_REG_0_APPS_ADDR A:0x61e04000
y.create.l HWIO_APPS_SMMU_SSD_REG_1_APPS_ADDR A:0x61e04004
y.create.l HWIO_APPS_SMMU_SSD_REG_2_APPS_ADDR A:0x61e04008
y.create.l HWIO_APPS_SMMU_SSD_REG_3_APPS_ADDR A:0x61e0400c
y.create.l HWIO_APPS_SMMU_SSD_REG_4_APPS_ADDR A:0x61e04010
y.create.l HWIO_APPS_SMMU_SSD_REG_5_APPS_ADDR A:0x61e04014
y.create.l HWIO_APPS_SMMU_SSD_REG_6_APPS_ADDR A:0x61e04018
y.create.l HWIO_APPS_SMMU_SSD_REG_7_APPS_ADDR A:0x61e0401c
y.create.l HWIO_APPS_SMMU_SSD_REG_8_APPS_ADDR A:0x61e04020
y.create.l HWIO_APPS_SMMU_SSD_REG_9_APPS_ADDR A:0x61e04024
y.create.l HWIO_APPS_SMMU_SSD_REG_10_APPS_ADDR A:0x61e04028
y.create.l HWIO_APPS_SMMU_SSD_REG_11_APPS_ADDR A:0x61e0402c
y.create.l HWIO_APPS_SMMU_SSD_REG_12_APPS_ADDR A:0x61e04030
y.create.l HWIO_APPS_SMMU_SSD_REG_13_APPS_ADDR A:0x61e04034
y.create.l HWIO_APPS_SMMU_SSD_REG_14_APPS_ADDR A:0x61e04038
y.create.l HWIO_APPS_SMMU_SSD_REG_15_APPS_ADDR A:0x61e0403c
y.create.l HWIO_APPS_SMMU_SSD_REG_16_APPS_ADDR A:0x61e04040
y.create.l HWIO_APPS_SMMU_SSD_REG_17_APPS_ADDR A:0x61e04044
y.create.l HWIO_APPS_SMMU_SSD_REG_18_APPS_ADDR A:0x61e04048
y.create.l HWIO_APPS_SMMU_SSD_REG_19_APPS_ADDR A:0x61e0404c
y.create.l HWIO_APPS_SMMU_SSD_REG_20_APPS_ADDR A:0x61e04050
y.create.l HWIO_APPS_SMMU_SSD_REG_21_APPS_ADDR A:0x61e04054
y.create.l HWIO_APPS_SMMU_SSD_REG_22_APPS_ADDR A:0x61e04058
y.create.l HWIO_APPS_SMMU_SSD_REG_23_APPS_ADDR A:0x61e0405c
y.create.l HWIO_APPS_SMMU_SSD_REG_24_APPS_ADDR A:0x61e04060
y.create.l HWIO_APPS_SMMU_SSD_REG_25_APPS_ADDR A:0x61e04064
y.create.l HWIO_APPS_SMMU_SSD_REG_26_APPS_ADDR A:0x61e04068
y.create.l HWIO_APPS_SMMU_SSD_REG_27_APPS_ADDR A:0x61e0406c
y.create.l HWIO_APPS_SMMU_SSD_REG_28_APPS_ADDR A:0x61e04070
y.create.l HWIO_APPS_SMMU_SSD_REG_29_APPS_ADDR A:0x61e04074
y.create.l HWIO_APPS_SMMU_SSD_REG_30_APPS_ADDR A:0x61e04078
y.create.l HWIO_APPS_SMMU_SSD_REG_31_APPS_ADDR A:0x61e0407c
y.create.l HWIO_APPS_SMMU_SSD_REG_32_APPS_ADDR A:0x61e04080
y.create.l HWIO_APPS_SMMU_SSD_REG_33_APPS_ADDR A:0x61e04084
y.create.l HWIO_APPS_SMMU_SSD_REG_34_APPS_ADDR A:0x61e04088
y.create.l HWIO_APPS_SMMU_SSD_REG_35_APPS_ADDR A:0x61e0408c
y.create.l HWIO_APPS_SMMU_SSD_REG_36_APPS_ADDR A:0x61e04090
y.create.l HWIO_APPS_SMMU_SSD_REG_37_APPS_ADDR A:0x61e04094
y.create.l HWIO_APPS_SMMU_SSD_REG_38_APPS_ADDR A:0x61e04098
y.create.l HWIO_APPS_SMMU_SSD_REG_39_APPS_ADDR A:0x61e0409c
y.create.l HWIO_APPS_SMMU_SSD_REG_40_APPS_ADDR A:0x61e040a0
y.create.l HWIO_APPS_SMMU_SSD_REG_41_APPS_ADDR A:0x61e040a4
y.create.l HWIO_APPS_SMMU_SSD_REG_42_APPS_ADDR A:0x61e040a8
y.create.l HWIO_APPS_SMMU_SSD_REG_43_APPS_ADDR A:0x61e040ac
y.create.l HWIO_APPS_SMMU_SSD_REG_44_APPS_ADDR A:0x61e040b0
y.create.l HWIO_APPS_SMMU_SSD_REG_45_APPS_ADDR A:0x61e040b4
y.create.l HWIO_APPS_SMMU_SSD_REG_46_APPS_ADDR A:0x61e040b8
y.create.l HWIO_APPS_SMMU_SSD_REG_47_APPS_ADDR A:0x61e040bc
y.create.l HWIO_APPS_SMMU_SSD_REG_48_APPS_ADDR A:0x61e040c0
y.create.l HWIO_APPS_SMMU_SSD_REG_49_APPS_ADDR A:0x61e040c4
y.create.l HWIO_APPS_SMMU_SSD_REG_50_APPS_ADDR A:0x61e040c8
y.create.l HWIO_APPS_SMMU_SSD_REG_51_APPS_ADDR A:0x61e040cc
y.create.l HWIO_APPS_SMMU_SSD_REG_52_APPS_ADDR A:0x61e040d0
y.create.l HWIO_APPS_SMMU_SSD_REG_53_APPS_ADDR A:0x61e040d4
y.create.l HWIO_APPS_SMMU_SSD_REG_54_APPS_ADDR A:0x61e040d8
y.create.l HWIO_APPS_SMMU_SSD_REG_55_APPS_ADDR A:0x61e040dc
y.create.l HWIO_APPS_SMMU_SSD_REG_56_APPS_ADDR A:0x61e040e0
y.create.l HWIO_APPS_SMMU_SSD_REG_57_APPS_ADDR A:0x61e040e4
y.create.l HWIO_APPS_SMMU_SSD_REG_58_APPS_ADDR A:0x61e040e8
y.create.l HWIO_APPS_SMMU_SSD_REG_59_APPS_ADDR A:0x61e040ec
y.create.l HWIO_APPS_SMMU_SSD_REG_60_APPS_ADDR A:0x61e040f0
y.create.l HWIO_APPS_SMMU_SSD_REG_61_APPS_ADDR A:0x61e040f4
y.create.l HWIO_APPS_SMMU_SSD_REG_62_APPS_ADDR A:0x61e040f8
y.create.l HWIO_APPS_SMMU_SSD_REG_63_APPS_ADDR A:0x61e040fc
y.create.l HWIO_APPS_SMMU_SSD_REG_64_APPS_ADDR A:0x61e04100
y.create.l HWIO_APPS_SMMU_SSD_REG_65_APPS_ADDR A:0x61e04104
y.create.l HWIO_APPS_SMMU_SSD_REG_66_APPS_ADDR A:0x61e04108
y.create.l HWIO_APPS_SMMU_SSD_REG_67_APPS_ADDR A:0x61e0410c
y.create.l HWIO_APPS_SMMU_SSD_REG_68_APPS_ADDR A:0x61e04110
y.create.l HWIO_APPS_SMMU_SSD_REG_69_APPS_ADDR A:0x61e04114
y.create.l HWIO_APPS_SMMU_SSD_REG_70_APPS_ADDR A:0x61e04118
y.create.l HWIO_APPS_SMMU_SSD_REG_71_APPS_ADDR A:0x61e0411c
y.create.l HWIO_APPS_SMMU_SSD_REG_72_APPS_ADDR A:0x61e04120
y.create.l HWIO_APPS_SMMU_SSD_REG_73_APPS_ADDR A:0x61e04124
y.create.l HWIO_APPS_SMMU_SSD_REG_74_APPS_ADDR A:0x61e04128
y.create.l HWIO_APPS_SMMU_SSD_REG_75_APPS_ADDR A:0x61e0412c
y.create.l HWIO_APPS_SMMU_SSD_REG_76_APPS_ADDR A:0x61e04130
y.create.l HWIO_APPS_SMMU_SSD_REG_77_APPS_ADDR A:0x61e04134
y.create.l HWIO_APPS_SMMU_SSD_REG_78_APPS_ADDR A:0x61e04138
y.create.l HWIO_APPS_SMMU_SSD_REG_79_APPS_ADDR A:0x61e0413c
y.create.l HWIO_APPS_SMMU_SSD_REG_80_APPS_ADDR A:0x61e04140
y.create.l HWIO_APPS_SMMU_SSD_REG_81_APPS_ADDR A:0x61e04144
y.create.l HWIO_APPS_SMMU_SSD_REG_82_APPS_ADDR A:0x61e04148
y.create.l HWIO_APPS_SMMU_SSD_REG_83_APPS_ADDR A:0x61e0414c
y.create.l HWIO_APPS_SMMU_SSD_REG_84_APPS_ADDR A:0x61e04150
y.create.l HWIO_APPS_SMMU_SSD_REG_85_APPS_ADDR A:0x61e04154
y.create.l HWIO_APPS_SMMU_SSD_REG_86_APPS_ADDR A:0x61e04158
y.create.l HWIO_APPS_SMMU_SSD_REG_87_APPS_ADDR A:0x61e0415c
y.create.l HWIO_APPS_SMMU_SSD_REG_88_APPS_ADDR A:0x61e04160
y.create.l HWIO_APPS_SMMU_SSD_REG_89_APPS_ADDR A:0x61e04164
y.create.l HWIO_APPS_SMMU_SSD_REG_90_APPS_ADDR A:0x61e04168
y.create.l HWIO_APPS_SMMU_SSD_REG_91_APPS_ADDR A:0x61e0416c
y.create.l HWIO_APPS_SMMU_SSD_REG_92_APPS_ADDR A:0x61e04170
y.create.l HWIO_APPS_SMMU_SSD_REG_93_APPS_ADDR A:0x61e04174
y.create.l HWIO_APPS_SMMU_SSD_REG_94_APPS_ADDR A:0x61e04178
y.create.l HWIO_APPS_SMMU_SSD_REG_95_APPS_ADDR A:0x61e0417c
y.create.l HWIO_APPS_SMMU_SSD_REG_96_APPS_ADDR A:0x61e04180
y.create.l HWIO_APPS_SMMU_SSD_REG_97_APPS_ADDR A:0x61e04184
y.create.l HWIO_APPS_SMMU_SSD_REG_98_APPS_ADDR A:0x61e04188
y.create.l HWIO_APPS_SMMU_SSD_REG_99_APPS_ADDR A:0x61e0418c
y.create.l HWIO_APPS_SMMU_SSD_REG_100_APPS_ADDR A:0x61e04190
y.create.l HWIO_APPS_SMMU_SSD_REG_101_APPS_ADDR A:0x61e04194
y.create.l HWIO_APPS_SMMU_SSD_REG_102_APPS_ADDR A:0x61e04198
y.create.l HWIO_APPS_SMMU_SSD_REG_103_APPS_ADDR A:0x61e0419c
y.create.l HWIO_APPS_SMMU_SSD_REG_104_APPS_ADDR A:0x61e041a0
y.create.l HWIO_APPS_SMMU_SSD_REG_105_APPS_ADDR A:0x61e041a4
y.create.l HWIO_APPS_SMMU_SSD_REG_106_APPS_ADDR A:0x61e041a8
y.create.l HWIO_APPS_SMMU_SSD_REG_107_APPS_ADDR A:0x61e041ac
y.create.l HWIO_APPS_SMMU_SSD_REG_108_APPS_ADDR A:0x61e041b0
y.create.l HWIO_APPS_SMMU_SSD_REG_109_APPS_ADDR A:0x61e041b4
y.create.l HWIO_APPS_SMMU_SSD_REG_110_APPS_ADDR A:0x61e041b8
y.create.l HWIO_APPS_SMMU_SSD_REG_111_APPS_ADDR A:0x61e041bc
y.create.l HWIO_APPS_SMMU_SSD_REG_112_APPS_ADDR A:0x61e041c0
y.create.l HWIO_APPS_SMMU_SSD_REG_113_APPS_ADDR A:0x61e041c4
y.create.l HWIO_APPS_SMMU_SSD_REG_114_APPS_ADDR A:0x61e041c8
y.create.l HWIO_APPS_SMMU_SSD_REG_115_APPS_ADDR A:0x61e041cc
y.create.l HWIO_APPS_SMMU_SSD_REG_116_APPS_ADDR A:0x61e041d0
y.create.l HWIO_APPS_SMMU_SSD_REG_117_APPS_ADDR A:0x61e041d4
y.create.l HWIO_APPS_SMMU_SSD_REG_118_APPS_ADDR A:0x61e041d8
y.create.l HWIO_APPS_SMMU_SSD_REG_119_APPS_ADDR A:0x61e041dc
y.create.l HWIO_APPS_SMMU_SSD_REG_120_APPS_ADDR A:0x61e041e0
y.create.l HWIO_APPS_SMMU_SSD_REG_121_APPS_ADDR A:0x61e041e4
y.create.l HWIO_APPS_SMMU_SSD_REG_122_APPS_ADDR A:0x61e041e8
y.create.l HWIO_APPS_SMMU_SSD_REG_123_APPS_ADDR A:0x61e041ec
y.create.l HWIO_APPS_SMMU_SSD_REG_124_APPS_ADDR A:0x61e041f0
y.create.l HWIO_APPS_SMMU_SSD_REG_125_APPS_ADDR A:0x61e041f4
y.create.l HWIO_APPS_SMMU_SSD_REG_126_APPS_ADDR A:0x61e041f8
y.create.l HWIO_APPS_SMMU_SSD_REG_127_APPS_ADDR A:0x61e041fc
y.create.l HWIO_APPS_SMMU_SSD_REG_128_APPS_ADDR A:0x61e04200
y.create.l HWIO_APPS_SMMU_SSD_REG_129_APPS_ADDR A:0x61e04204
y.create.l HWIO_APPS_SMMU_SSD_REG_130_APPS_ADDR A:0x61e04208
y.create.l HWIO_APPS_SMMU_SSD_REG_131_APPS_ADDR A:0x61e0420c
y.create.l HWIO_APPS_SMMU_SSD_REG_132_APPS_ADDR A:0x61e04210
y.create.l HWIO_APPS_SMMU_SSD_REG_133_APPS_ADDR A:0x61e04214
y.create.l HWIO_APPS_SMMU_SSD_REG_134_APPS_ADDR A:0x61e04218
y.create.l HWIO_APPS_SMMU_SSD_REG_135_APPS_ADDR A:0x61e0421c
y.create.l HWIO_APPS_SMMU_SSD_REG_136_APPS_ADDR A:0x61e04220
y.create.l HWIO_APPS_SMMU_SSD_REG_137_APPS_ADDR A:0x61e04224
y.create.l HWIO_APPS_SMMU_SSD_REG_138_APPS_ADDR A:0x61e04228
y.create.l HWIO_APPS_SMMU_SSD_REG_139_APPS_ADDR A:0x61e0422c
y.create.l HWIO_APPS_SMMU_SSD_REG_140_APPS_ADDR A:0x61e04230
y.create.l HWIO_APPS_SMMU_SSD_REG_141_APPS_ADDR A:0x61e04234
y.create.l HWIO_APPS_SMMU_SSD_REG_142_APPS_ADDR A:0x61e04238
y.create.l HWIO_APPS_SMMU_SSD_REG_143_APPS_ADDR A:0x61e0423c
y.create.l HWIO_APPS_SMMU_SSD_REG_144_APPS_ADDR A:0x61e04240
y.create.l HWIO_APPS_SMMU_SSD_REG_145_APPS_ADDR A:0x61e04244
y.create.l HWIO_APPS_SMMU_SSD_REG_146_APPS_ADDR A:0x61e04248
y.create.l HWIO_APPS_SMMU_SSD_REG_147_APPS_ADDR A:0x61e0424c
y.create.l HWIO_APPS_SMMU_SSD_REG_148_APPS_ADDR A:0x61e04250
y.create.l HWIO_APPS_SMMU_SSD_REG_149_APPS_ADDR A:0x61e04254
y.create.l HWIO_APPS_SMMU_SSD_REG_150_APPS_ADDR A:0x61e04258
y.create.l HWIO_APPS_SMMU_SSD_REG_151_APPS_ADDR A:0x61e0425c
y.create.l HWIO_APPS_SMMU_SSD_REG_152_APPS_ADDR A:0x61e04260
y.create.l HWIO_APPS_SMMU_SSD_REG_153_APPS_ADDR A:0x61e04264
y.create.l HWIO_APPS_SMMU_SSD_REG_154_APPS_ADDR A:0x61e04268
y.create.l HWIO_APPS_SMMU_SSD_REG_155_APPS_ADDR A:0x61e0426c
y.create.l HWIO_APPS_SMMU_SSD_REG_156_APPS_ADDR A:0x61e04270
y.create.l HWIO_APPS_SMMU_SSD_REG_157_APPS_ADDR A:0x61e04274
y.create.l HWIO_APPS_SMMU_SSD_REG_158_APPS_ADDR A:0x61e04278
y.create.l HWIO_APPS_SMMU_SSD_REG_159_APPS_ADDR A:0x61e0427c
y.create.l HWIO_APPS_SMMU_SSD_REG_160_APPS_ADDR A:0x61e04280
y.create.l HWIO_APPS_SMMU_SSD_REG_161_APPS_ADDR A:0x61e04284
y.create.l HWIO_APPS_SMMU_SSD_REG_162_APPS_ADDR A:0x61e04288
y.create.l HWIO_APPS_SMMU_SSD_REG_163_APPS_ADDR A:0x61e0428c
y.create.l HWIO_APPS_SMMU_SSD_REG_164_APPS_ADDR A:0x61e04290
y.create.l HWIO_APPS_SMMU_SSD_REG_165_APPS_ADDR A:0x61e04294
y.create.l HWIO_APPS_SMMU_SSD_REG_166_APPS_ADDR A:0x61e04298
y.create.l HWIO_APPS_SMMU_SSD_REG_167_APPS_ADDR A:0x61e0429c
y.create.l HWIO_APPS_SMMU_SSD_REG_168_APPS_ADDR A:0x61e042a0
y.create.l HWIO_APPS_SMMU_SSD_REG_169_APPS_ADDR A:0x61e042a4
y.create.l HWIO_APPS_SMMU_SSD_REG_170_APPS_ADDR A:0x61e042a8
y.create.l HWIO_APPS_SMMU_SSD_REG_171_APPS_ADDR A:0x61e042ac
y.create.l HWIO_APPS_SMMU_SSD_REG_172_APPS_ADDR A:0x61e042b0
y.create.l HWIO_APPS_SMMU_SSD_REG_173_APPS_ADDR A:0x61e042b4
y.create.l HWIO_APPS_SMMU_SSD_REG_174_APPS_ADDR A:0x61e042b8
y.create.l HWIO_APPS_SMMU_SSD_REG_175_APPS_ADDR A:0x61e042bc
y.create.l HWIO_APPS_SMMU_SSD_REG_176_APPS_ADDR A:0x61e042c0
y.create.l HWIO_APPS_SMMU_SSD_REG_177_APPS_ADDR A:0x61e042c4
y.create.l HWIO_APPS_SMMU_SSD_REG_178_APPS_ADDR A:0x61e042c8
y.create.l HWIO_APPS_SMMU_SSD_REG_179_APPS_ADDR A:0x61e042cc
y.create.l HWIO_APPS_SMMU_SSD_REG_180_APPS_ADDR A:0x61e042d0
y.create.l HWIO_APPS_SMMU_SSD_REG_181_APPS_ADDR A:0x61e042d4
y.create.l HWIO_APPS_SMMU_SSD_REG_182_APPS_ADDR A:0x61e042d8
y.create.l HWIO_APPS_SMMU_SSD_REG_183_APPS_ADDR A:0x61e042dc
y.create.l HWIO_APPS_SMMU_SSD_REG_184_APPS_ADDR A:0x61e042e0
y.create.l HWIO_APPS_SMMU_SSD_REG_185_APPS_ADDR A:0x61e042e4
y.create.l HWIO_APPS_SMMU_SSD_REG_186_APPS_ADDR A:0x61e042e8
y.create.l HWIO_APPS_SMMU_SSD_REG_187_APPS_ADDR A:0x61e042ec
y.create.l HWIO_APPS_SMMU_SSD_REG_188_APPS_ADDR A:0x61e042f0
y.create.l HWIO_APPS_SMMU_SSD_REG_189_APPS_ADDR A:0x61e042f4
y.create.l HWIO_APPS_SMMU_SSD_REG_190_APPS_ADDR A:0x61e042f8
y.create.l HWIO_APPS_SMMU_SSD_REG_191_APPS_ADDR A:0x61e042fc
y.create.l HWIO_APPS_SMMU_SSD_REG_192_APPS_ADDR A:0x61e04300
y.create.l HWIO_APPS_SMMU_SSD_REG_193_APPS_ADDR A:0x61e04304
y.create.l HWIO_APPS_SMMU_SSD_REG_194_APPS_ADDR A:0x61e04308
y.create.l HWIO_APPS_SMMU_SSD_REG_195_APPS_ADDR A:0x61e0430c
y.create.l HWIO_APPS_SMMU_SSD_REG_196_APPS_ADDR A:0x61e04310
y.create.l HWIO_APPS_SMMU_SSD_REG_197_APPS_ADDR A:0x61e04314
y.create.l HWIO_APPS_SMMU_SSD_REG_198_APPS_ADDR A:0x61e04318
y.create.l HWIO_APPS_SMMU_SSD_REG_199_APPS_ADDR A:0x61e0431c
y.create.l HWIO_APPS_SMMU_SSD_REG_200_APPS_ADDR A:0x61e04320
y.create.l HWIO_APPS_SMMU_SSD_REG_201_APPS_ADDR A:0x61e04324
y.create.l HWIO_APPS_SMMU_SSD_REG_202_APPS_ADDR A:0x61e04328
y.create.l HWIO_APPS_SMMU_SSD_REG_203_APPS_ADDR A:0x61e0432c
y.create.l HWIO_APPS_SMMU_SSD_REG_204_APPS_ADDR A:0x61e04330
y.create.l HWIO_APPS_SMMU_SSD_REG_205_APPS_ADDR A:0x61e04334
y.create.l HWIO_APPS_SMMU_SSD_REG_206_APPS_ADDR A:0x61e04338
y.create.l HWIO_APPS_SMMU_SSD_REG_207_APPS_ADDR A:0x61e0433c
y.create.l HWIO_APPS_SMMU_SSD_REG_208_APPS_ADDR A:0x61e04340
y.create.l HWIO_APPS_SMMU_SSD_REG_209_APPS_ADDR A:0x61e04344
y.create.l HWIO_APPS_SMMU_SSD_REG_210_APPS_ADDR A:0x61e04348
y.create.l HWIO_APPS_SMMU_SSD_REG_211_APPS_ADDR A:0x61e0434c
y.create.l HWIO_APPS_SMMU_SSD_REG_212_APPS_ADDR A:0x61e04350
y.create.l HWIO_APPS_SMMU_SSD_REG_213_APPS_ADDR A:0x61e04354
y.create.l HWIO_APPS_SMMU_SSD_REG_214_APPS_ADDR A:0x61e04358
y.create.l HWIO_APPS_SMMU_SSD_REG_215_APPS_ADDR A:0x61e0435c
y.create.l HWIO_APPS_SMMU_SSD_REG_216_APPS_ADDR A:0x61e04360
y.create.l HWIO_APPS_SMMU_SSD_REG_217_APPS_ADDR A:0x61e04364
y.create.l HWIO_APPS_SMMU_SSD_REG_218_APPS_ADDR A:0x61e04368
y.create.l HWIO_APPS_SMMU_SSD_REG_219_APPS_ADDR A:0x61e0436c
y.create.l HWIO_APPS_SMMU_SSD_REG_220_APPS_ADDR A:0x61e04370
y.create.l HWIO_APPS_SMMU_SSD_REG_221_APPS_ADDR A:0x61e04374
y.create.l HWIO_APPS_SMMU_SSD_REG_222_APPS_ADDR A:0x61e04378
y.create.l HWIO_APPS_SMMU_SSD_REG_223_APPS_ADDR A:0x61e0437c
y.create.l HWIO_APPS_SMMU_SSD_REG_224_APPS_ADDR A:0x61e04380
y.create.l HWIO_APPS_SMMU_SSD_REG_225_APPS_ADDR A:0x61e04384
y.create.l HWIO_APPS_SMMU_SSD_REG_226_APPS_ADDR A:0x61e04388
y.create.l HWIO_APPS_SMMU_SSD_REG_227_APPS_ADDR A:0x61e0438c
y.create.l HWIO_APPS_SMMU_SSD_REG_228_APPS_ADDR A:0x61e04390
y.create.l HWIO_APPS_SMMU_SSD_REG_229_APPS_ADDR A:0x61e04394
y.create.l HWIO_APPS_SMMU_SSD_REG_230_APPS_ADDR A:0x61e04398
y.create.l HWIO_APPS_SMMU_SSD_REG_231_APPS_ADDR A:0x61e0439c
y.create.l HWIO_APPS_SMMU_SSD_REG_232_APPS_ADDR A:0x61e043a0
y.create.l HWIO_APPS_SMMU_SSD_REG_233_APPS_ADDR A:0x61e043a4
y.create.l HWIO_APPS_SMMU_SSD_REG_234_APPS_ADDR A:0x61e043a8
y.create.l HWIO_APPS_SMMU_SSD_REG_235_APPS_ADDR A:0x61e043ac
y.create.l HWIO_APPS_SMMU_SSD_REG_236_APPS_ADDR A:0x61e043b0
y.create.l HWIO_APPS_SMMU_SSD_REG_237_APPS_ADDR A:0x61e043b4
y.create.l HWIO_APPS_SMMU_SSD_REG_238_APPS_ADDR A:0x61e043b8
y.create.l HWIO_APPS_SMMU_SSD_REG_239_APPS_ADDR A:0x61e043bc
y.create.l HWIO_APPS_SMMU_SSD_REG_240_APPS_ADDR A:0x61e043c0
y.create.l HWIO_APPS_SMMU_SSD_REG_241_APPS_ADDR A:0x61e043c4
y.create.l HWIO_APPS_SMMU_SSD_REG_242_APPS_ADDR A:0x61e043c8
y.create.l HWIO_APPS_SMMU_SSD_REG_243_APPS_ADDR A:0x61e043cc
y.create.l HWIO_APPS_SMMU_SSD_REG_244_APPS_ADDR A:0x61e043d0
y.create.l HWIO_APPS_SMMU_SSD_REG_245_APPS_ADDR A:0x61e043d4
y.create.l HWIO_APPS_SMMU_SSD_REG_246_APPS_ADDR A:0x61e043d8
y.create.l HWIO_APPS_SMMU_SSD_REG_247_APPS_ADDR A:0x61e043dc
y.create.l HWIO_APPS_SMMU_SSD_REG_248_APPS_ADDR A:0x61e043e0
y.create.l HWIO_APPS_SMMU_SSD_REG_249_APPS_ADDR A:0x61e043e4
y.create.l HWIO_APPS_SMMU_SSD_REG_250_APPS_ADDR A:0x61e043e8
y.create.l HWIO_APPS_SMMU_SSD_REG_251_APPS_ADDR A:0x61e043ec
y.create.l HWIO_APPS_SMMU_SSD_REG_252_APPS_ADDR A:0x61e043f0
y.create.l HWIO_APPS_SMMU_SSD_REG_253_APPS_ADDR A:0x61e043f4
y.create.l HWIO_APPS_SMMU_SSD_REG_254_APPS_ADDR A:0x61e043f8
y.create.l HWIO_APPS_SMMU_SSD_REG_255_APPS_ADDR A:0x61e043fc
y.create.l HWIO_APPS_SMMU_SSD_REG_256_APPS_ADDR A:0x61e04400
y.create.l HWIO_APPS_SMMU_SSD_REG_257_APPS_ADDR A:0x61e04404
y.create.l HWIO_APPS_SMMU_SSD_REG_258_APPS_ADDR A:0x61e04408
y.create.l HWIO_APPS_SMMU_SSD_REG_259_APPS_ADDR A:0x61e0440c
y.create.l HWIO_APPS_SMMU_SSD_REG_260_APPS_ADDR A:0x61e04410
y.create.l HWIO_APPS_SMMU_SSD_REG_261_APPS_ADDR A:0x61e04414
y.create.l HWIO_APPS_SMMU_SSD_REG_262_APPS_ADDR A:0x61e04418
y.create.l HWIO_APPS_SMMU_SSD_REG_263_APPS_ADDR A:0x61e0441c
y.create.l HWIO_APPS_SMMU_SSD_REG_264_APPS_ADDR A:0x61e04420
y.create.l HWIO_APPS_SMMU_SSD_REG_265_APPS_ADDR A:0x61e04424
y.create.l HWIO_APPS_SMMU_SSD_REG_266_APPS_ADDR A:0x61e04428
y.create.l HWIO_APPS_SMMU_SSD_REG_267_APPS_ADDR A:0x61e0442c
y.create.l HWIO_APPS_SMMU_SSD_REG_268_APPS_ADDR A:0x61e04430
y.create.l HWIO_APPS_SMMU_SSD_REG_269_APPS_ADDR A:0x61e04434
y.create.l HWIO_APPS_SMMU_SSD_REG_270_APPS_ADDR A:0x61e04438
y.create.l HWIO_APPS_SMMU_SSD_REG_271_APPS_ADDR A:0x61e0443c
y.create.l HWIO_APPS_SMMU_SSD_REG_272_APPS_ADDR A:0x61e04440
y.create.l HWIO_APPS_SMMU_SSD_REG_273_APPS_ADDR A:0x61e04444
y.create.l HWIO_APPS_SMMU_SSD_REG_274_APPS_ADDR A:0x61e04448
y.create.l HWIO_APPS_SMMU_SSD_REG_275_APPS_ADDR A:0x61e0444c
y.create.l HWIO_APPS_SMMU_SSD_REG_276_APPS_ADDR A:0x61e04450
y.create.l HWIO_APPS_SMMU_SSD_REG_277_APPS_ADDR A:0x61e04454
y.create.l HWIO_APPS_SMMU_SSD_REG_278_APPS_ADDR A:0x61e04458
y.create.l HWIO_APPS_SMMU_SSD_REG_279_APPS_ADDR A:0x61e0445c
y.create.l HWIO_APPS_SMMU_SSD_REG_280_APPS_ADDR A:0x61e04460
y.create.l HWIO_APPS_SMMU_SSD_REG_281_APPS_ADDR A:0x61e04464
y.create.l HWIO_APPS_SMMU_SSD_REG_282_APPS_ADDR A:0x61e04468
y.create.l HWIO_APPS_SMMU_SSD_REG_283_APPS_ADDR A:0x61e0446c
y.create.l HWIO_APPS_SMMU_SSD_REG_284_APPS_ADDR A:0x61e04470
y.create.l HWIO_APPS_SMMU_SSD_REG_285_APPS_ADDR A:0x61e04474
y.create.l HWIO_APPS_SMMU_SSD_REG_286_APPS_ADDR A:0x61e04478
y.create.l HWIO_APPS_SMMU_SSD_REG_287_APPS_ADDR A:0x61e0447c
y.create.l HWIO_APPS_SMMU_SSD_REG_288_APPS_ADDR A:0x61e04480
y.create.l HWIO_APPS_SMMU_SSD_REG_289_APPS_ADDR A:0x61e04484
y.create.l HWIO_APPS_SMMU_SSD_REG_290_APPS_ADDR A:0x61e04488
y.create.l HWIO_APPS_SMMU_SSD_REG_291_APPS_ADDR A:0x61e0448c
y.create.l HWIO_APPS_SMMU_SSD_REG_292_APPS_ADDR A:0x61e04490
y.create.l HWIO_APPS_SMMU_SSD_REG_293_APPS_ADDR A:0x61e04494
y.create.l HWIO_APPS_SMMU_SSD_REG_294_APPS_ADDR A:0x61e04498
y.create.l HWIO_APPS_SMMU_SSD_REG_295_APPS_ADDR A:0x61e0449c
y.create.l HWIO_APPS_SMMU_SSD_REG_296_APPS_ADDR A:0x61e044a0
y.create.l HWIO_APPS_SMMU_SSD_REG_297_APPS_ADDR A:0x61e044a4
y.create.l HWIO_APPS_SMMU_SSD_REG_298_APPS_ADDR A:0x61e044a8
y.create.l HWIO_APPS_SMMU_SSD_REG_299_APPS_ADDR A:0x61e044ac
y.create.l HWIO_APPS_SMMU_SSD_REG_300_APPS_ADDR A:0x61e044b0
y.create.l HWIO_APPS_SMMU_SSD_REG_301_APPS_ADDR A:0x61e044b4
y.create.l HWIO_APPS_SMMU_SSD_REG_302_APPS_ADDR A:0x61e044b8
y.create.l HWIO_APPS_SMMU_SSD_REG_303_APPS_ADDR A:0x61e044bc
y.create.l HWIO_APPS_SMMU_SSD_REG_304_APPS_ADDR A:0x61e044c0
y.create.l HWIO_APPS_SMMU_SSD_REG_305_APPS_ADDR A:0x61e044c4
y.create.l HWIO_APPS_SMMU_SSD_REG_306_APPS_ADDR A:0x61e044c8
y.create.l HWIO_APPS_SMMU_SSD_REG_307_APPS_ADDR A:0x61e044cc
y.create.l HWIO_APPS_SMMU_SSD_REG_308_APPS_ADDR A:0x61e044d0
y.create.l HWIO_APPS_SMMU_SSD_REG_309_APPS_ADDR A:0x61e044d4
y.create.l HWIO_APPS_SMMU_SSD_REG_310_APPS_ADDR A:0x61e044d8
y.create.l HWIO_APPS_SMMU_SSD_REG_311_APPS_ADDR A:0x61e044dc
y.create.l HWIO_APPS_SMMU_SSD_REG_312_APPS_ADDR A:0x61e044e0
y.create.l HWIO_APPS_SMMU_SSD_REG_313_APPS_ADDR A:0x61e044e4
y.create.l HWIO_APPS_SMMU_SSD_REG_314_APPS_ADDR A:0x61e044e8
y.create.l HWIO_APPS_SMMU_SSD_REG_315_APPS_ADDR A:0x61e044ec
y.create.l HWIO_APPS_SMMU_SSD_REG_316_APPS_ADDR A:0x61e044f0
y.create.l HWIO_APPS_SMMU_SSD_REG_317_APPS_ADDR A:0x61e044f4
y.create.l HWIO_APPS_SMMU_SSD_REG_318_APPS_ADDR A:0x61e044f8
y.create.l HWIO_APPS_SMMU_SSD_REG_319_APPS_ADDR A:0x61e044fc
y.create.l HWIO_APPS_SMMU_SSD_REG_320_APPS_ADDR A:0x61e04500
y.create.l HWIO_APPS_SMMU_SSD_REG_321_APPS_ADDR A:0x61e04504
y.create.l HWIO_APPS_SMMU_SSD_REG_322_APPS_ADDR A:0x61e04508
y.create.l HWIO_APPS_SMMU_SSD_REG_323_APPS_ADDR A:0x61e0450c
y.create.l HWIO_APPS_SMMU_SSD_REG_324_APPS_ADDR A:0x61e04510
y.create.l HWIO_APPS_SMMU_SSD_REG_325_APPS_ADDR A:0x61e04514
y.create.l HWIO_APPS_SMMU_SSD_REG_326_APPS_ADDR A:0x61e04518
y.create.l HWIO_APPS_SMMU_SSD_REG_327_APPS_ADDR A:0x61e0451c
y.create.l HWIO_APPS_SMMU_SSD_REG_328_APPS_ADDR A:0x61e04520
y.create.l HWIO_APPS_SMMU_SSD_REG_329_APPS_ADDR A:0x61e04524
y.create.l HWIO_APPS_SMMU_SSD_REG_330_APPS_ADDR A:0x61e04528
y.create.l HWIO_APPS_SMMU_SSD_REG_331_APPS_ADDR A:0x61e0452c
y.create.l HWIO_APPS_SMMU_SSD_REG_332_APPS_ADDR A:0x61e04530
y.create.l HWIO_APPS_SMMU_SSD_REG_333_APPS_ADDR A:0x61e04534
y.create.l HWIO_APPS_SMMU_SSD_REG_334_APPS_ADDR A:0x61e04538
y.create.l HWIO_APPS_SMMU_SSD_REG_335_APPS_ADDR A:0x61e0453c
y.create.l HWIO_APPS_SMMU_SSD_REG_336_APPS_ADDR A:0x61e04540
y.create.l HWIO_APPS_SMMU_SSD_REG_337_APPS_ADDR A:0x61e04544
y.create.l HWIO_APPS_SMMU_SSD_REG_338_APPS_ADDR A:0x61e04548
y.create.l HWIO_APPS_SMMU_SSD_REG_339_APPS_ADDR A:0x61e0454c
y.create.l HWIO_APPS_SMMU_SSD_REG_340_APPS_ADDR A:0x61e04550
y.create.l HWIO_APPS_SMMU_SSD_REG_341_APPS_ADDR A:0x61e04554
y.create.l HWIO_APPS_SMMU_SSD_REG_342_APPS_ADDR A:0x61e04558
y.create.l HWIO_APPS_SMMU_SSD_REG_343_APPS_ADDR A:0x61e0455c
y.create.l HWIO_APPS_SMMU_SSD_REG_344_APPS_ADDR A:0x61e04560
y.create.l HWIO_APPS_SMMU_SSD_REG_345_APPS_ADDR A:0x61e04564
y.create.l HWIO_APPS_SMMU_SSD_REG_346_APPS_ADDR A:0x61e04568
y.create.l HWIO_APPS_SMMU_SSD_REG_347_APPS_ADDR A:0x61e0456c
y.create.l HWIO_APPS_SMMU_SSD_REG_348_APPS_ADDR A:0x61e04570
y.create.l HWIO_APPS_SMMU_SSD_REG_349_APPS_ADDR A:0x61e04574
y.create.l HWIO_APPS_SMMU_SSD_REG_350_APPS_ADDR A:0x61e04578
y.create.l HWIO_APPS_SMMU_SSD_REG_351_APPS_ADDR A:0x61e0457c
y.create.l HWIO_APPS_SMMU_SSD_REG_352_APPS_ADDR A:0x61e04580
y.create.l HWIO_APPS_SMMU_SSD_REG_353_APPS_ADDR A:0x61e04584
y.create.l HWIO_APPS_SMMU_SSD_REG_354_APPS_ADDR A:0x61e04588
y.create.l HWIO_APPS_SMMU_SSD_REG_355_APPS_ADDR A:0x61e0458c
y.create.l HWIO_APPS_SMMU_SSD_REG_356_APPS_ADDR A:0x61e04590
y.create.l HWIO_APPS_SMMU_SSD_REG_357_APPS_ADDR A:0x61e04594
y.create.l HWIO_APPS_SMMU_SSD_REG_358_APPS_ADDR A:0x61e04598
y.create.l HWIO_APPS_SMMU_SSD_REG_359_APPS_ADDR A:0x61e0459c
y.create.l HWIO_APPS_SMMU_SSD_REG_360_APPS_ADDR A:0x61e045a0
y.create.l HWIO_APPS_SMMU_SSD_REG_361_APPS_ADDR A:0x61e045a4
y.create.l HWIO_APPS_SMMU_SSD_REG_362_APPS_ADDR A:0x61e045a8
y.create.l HWIO_APPS_SMMU_SSD_REG_363_APPS_ADDR A:0x61e045ac
y.create.l HWIO_APPS_SMMU_SSD_REG_364_APPS_ADDR A:0x61e045b0
y.create.l HWIO_APPS_SMMU_SSD_REG_365_APPS_ADDR A:0x61e045b4
y.create.l HWIO_APPS_SMMU_SSD_REG_366_APPS_ADDR A:0x61e045b8
y.create.l HWIO_APPS_SMMU_SSD_REG_367_APPS_ADDR A:0x61e045bc
y.create.l HWIO_APPS_SMMU_SSD_REG_368_APPS_ADDR A:0x61e045c0
y.create.l HWIO_APPS_SMMU_SSD_REG_369_APPS_ADDR A:0x61e045c4
y.create.l HWIO_APPS_SMMU_SSD_REG_370_APPS_ADDR A:0x61e045c8
y.create.l HWIO_APPS_SMMU_SSD_REG_371_APPS_ADDR A:0x61e045cc
y.create.l HWIO_APPS_SMMU_SSD_REG_372_APPS_ADDR A:0x61e045d0
y.create.l HWIO_APPS_SMMU_SSD_REG_373_APPS_ADDR A:0x61e045d4
y.create.l HWIO_APPS_SMMU_SSD_REG_374_APPS_ADDR A:0x61e045d8
y.create.l HWIO_APPS_SMMU_SSD_REG_375_APPS_ADDR A:0x61e045dc
y.create.l HWIO_APPS_SMMU_SSD_REG_376_APPS_ADDR A:0x61e045e0
y.create.l HWIO_APPS_SMMU_SSD_REG_377_APPS_ADDR A:0x61e045e4
y.create.l HWIO_APPS_SMMU_SSD_REG_378_APPS_ADDR A:0x61e045e8
y.create.l HWIO_APPS_SMMU_SSD_REG_379_APPS_ADDR A:0x61e045ec
y.create.l HWIO_APPS_SMMU_SSD_REG_380_APPS_ADDR A:0x61e045f0
y.create.l HWIO_APPS_SMMU_SSD_REG_381_APPS_ADDR A:0x61e045f4
y.create.l HWIO_APPS_SMMU_SSD_REG_382_APPS_ADDR A:0x61e045f8
y.create.l HWIO_APPS_SMMU_SSD_REG_383_APPS_ADDR A:0x61e045fc
y.create.l HWIO_APPS_SMMU_SSD_REG_384_APPS_ADDR A:0x61e04600
y.create.l HWIO_APPS_SMMU_SSD_REG_385_APPS_ADDR A:0x61e04604
y.create.l HWIO_APPS_SMMU_SSD_REG_386_APPS_ADDR A:0x61e04608
y.create.l HWIO_APPS_SMMU_SSD_REG_387_APPS_ADDR A:0x61e0460c
y.create.l HWIO_APPS_SMMU_SSD_REG_388_APPS_ADDR A:0x61e04610
y.create.l HWIO_APPS_SMMU_SSD_REG_389_APPS_ADDR A:0x61e04614
y.create.l HWIO_APPS_SMMU_SSD_REG_390_APPS_ADDR A:0x61e04618
y.create.l HWIO_APPS_SMMU_SSD_REG_391_APPS_ADDR A:0x61e0461c
y.create.l HWIO_APPS_SMMU_SSD_REG_392_APPS_ADDR A:0x61e04620
y.create.l HWIO_APPS_SMMU_SSD_REG_393_APPS_ADDR A:0x61e04624
y.create.l HWIO_APPS_SMMU_SSD_REG_394_APPS_ADDR A:0x61e04628
y.create.l HWIO_APPS_SMMU_SSD_REG_395_APPS_ADDR A:0x61e0462c
y.create.l HWIO_APPS_SMMU_SSD_REG_396_APPS_ADDR A:0x61e04630
y.create.l HWIO_APPS_SMMU_SSD_REG_397_APPS_ADDR A:0x61e04634
y.create.l HWIO_APPS_SMMU_SSD_REG_398_APPS_ADDR A:0x61e04638
y.create.l HWIO_APPS_SMMU_SSD_REG_399_APPS_ADDR A:0x61e0463c
y.create.l HWIO_APPS_SMMU_SSD_REG_400_APPS_ADDR A:0x61e04640
y.create.l HWIO_APPS_SMMU_SSD_REG_401_APPS_ADDR A:0x61e04644
y.create.l HWIO_APPS_SMMU_SSD_REG_402_APPS_ADDR A:0x61e04648
y.create.l HWIO_APPS_SMMU_SSD_REG_403_APPS_ADDR A:0x61e0464c
y.create.l HWIO_APPS_SMMU_SSD_REG_404_APPS_ADDR A:0x61e04650
y.create.l HWIO_APPS_SMMU_SSD_REG_405_APPS_ADDR A:0x61e04654
y.create.l HWIO_APPS_SMMU_SSD_REG_406_APPS_ADDR A:0x61e04658
y.create.l HWIO_APPS_SMMU_SSD_REG_407_APPS_ADDR A:0x61e0465c
y.create.l HWIO_APPS_SMMU_SSD_REG_408_APPS_ADDR A:0x61e04660
y.create.l HWIO_APPS_SMMU_SSD_REG_409_APPS_ADDR A:0x61e04664
y.create.l HWIO_APPS_SMMU_SSD_REG_410_APPS_ADDR A:0x61e04668
y.create.l HWIO_APPS_SMMU_SSD_REG_411_APPS_ADDR A:0x61e0466c
y.create.l HWIO_APPS_SMMU_SSD_REG_412_APPS_ADDR A:0x61e04670
y.create.l HWIO_APPS_SMMU_SSD_REG_413_APPS_ADDR A:0x61e04674
y.create.l HWIO_APPS_SMMU_SSD_REG_414_APPS_ADDR A:0x61e04678
y.create.l HWIO_APPS_SMMU_SSD_REG_415_APPS_ADDR A:0x61e0467c
y.create.l HWIO_APPS_SMMU_SSD_REG_416_APPS_ADDR A:0x61e04680
y.create.l HWIO_APPS_SMMU_SSD_REG_417_APPS_ADDR A:0x61e04684
y.create.l HWIO_APPS_SMMU_SSD_REG_418_APPS_ADDR A:0x61e04688
y.create.l HWIO_APPS_SMMU_SSD_REG_419_APPS_ADDR A:0x61e0468c
y.create.l HWIO_APPS_SMMU_SSD_REG_420_APPS_ADDR A:0x61e04690
y.create.l HWIO_APPS_SMMU_SSD_REG_421_APPS_ADDR A:0x61e04694
y.create.l HWIO_APPS_SMMU_SSD_REG_422_APPS_ADDR A:0x61e04698
y.create.l HWIO_APPS_SMMU_SSD_REG_423_APPS_ADDR A:0x61e0469c
y.create.l HWIO_APPS_SMMU_SSD_REG_424_APPS_ADDR A:0x61e046a0
y.create.l HWIO_APPS_SMMU_SSD_REG_425_APPS_ADDR A:0x61e046a4
y.create.l HWIO_APPS_SMMU_SSD_REG_426_APPS_ADDR A:0x61e046a8
y.create.l HWIO_APPS_SMMU_SSD_REG_427_APPS_ADDR A:0x61e046ac
y.create.l HWIO_APPS_SMMU_SSD_REG_428_APPS_ADDR A:0x61e046b0
y.create.l HWIO_APPS_SMMU_SSD_REG_429_APPS_ADDR A:0x61e046b4
y.create.l HWIO_APPS_SMMU_SSD_REG_430_APPS_ADDR A:0x61e046b8
y.create.l HWIO_APPS_SMMU_SSD_REG_431_APPS_ADDR A:0x61e046bc
y.create.l HWIO_APPS_SMMU_SSD_REG_432_APPS_ADDR A:0x61e046c0
y.create.l HWIO_APPS_SMMU_SSD_REG_433_APPS_ADDR A:0x61e046c4
y.create.l HWIO_APPS_SMMU_SSD_REG_434_APPS_ADDR A:0x61e046c8
y.create.l HWIO_APPS_SMMU_SSD_REG_435_APPS_ADDR A:0x61e046cc
y.create.l HWIO_APPS_SMMU_SSD_REG_436_APPS_ADDR A:0x61e046d0
y.create.l HWIO_APPS_SMMU_SSD_REG_437_APPS_ADDR A:0x61e046d4
y.create.l HWIO_APPS_SMMU_SSD_REG_438_APPS_ADDR A:0x61e046d8
y.create.l HWIO_APPS_SMMU_SSD_REG_439_APPS_ADDR A:0x61e046dc
y.create.l HWIO_APPS_SMMU_SSD_REG_440_APPS_ADDR A:0x61e046e0
y.create.l HWIO_APPS_SMMU_SSD_REG_441_APPS_ADDR A:0x61e046e4
y.create.l HWIO_APPS_SMMU_SSD_REG_442_APPS_ADDR A:0x61e046e8
y.create.l HWIO_APPS_SMMU_SSD_REG_443_APPS_ADDR A:0x61e046ec
y.create.l HWIO_APPS_SMMU_SSD_REG_444_APPS_ADDR A:0x61e046f0
y.create.l HWIO_APPS_SMMU_SSD_REG_445_APPS_ADDR A:0x61e046f4
y.create.l HWIO_APPS_SMMU_SSD_REG_446_APPS_ADDR A:0x61e046f8
y.create.l HWIO_APPS_SMMU_SSD_REG_447_APPS_ADDR A:0x61e046fc
y.create.l HWIO_APPS_SMMU_SSD_REG_448_APPS_ADDR A:0x61e04700
y.create.l HWIO_APPS_SMMU_SSD_REG_449_APPS_ADDR A:0x61e04704
y.create.l HWIO_APPS_SMMU_SSD_REG_450_APPS_ADDR A:0x61e04708
y.create.l HWIO_APPS_SMMU_SSD_REG_451_APPS_ADDR A:0x61e0470c
y.create.l HWIO_APPS_SMMU_SSD_REG_452_APPS_ADDR A:0x61e04710
y.create.l HWIO_APPS_SMMU_SSD_REG_453_APPS_ADDR A:0x61e04714
y.create.l HWIO_APPS_SMMU_SSD_REG_454_APPS_ADDR A:0x61e04718
y.create.l HWIO_APPS_SMMU_SSD_REG_455_APPS_ADDR A:0x61e0471c
y.create.l HWIO_APPS_SMMU_SSD_REG_456_APPS_ADDR A:0x61e04720
y.create.l HWIO_APPS_SMMU_SSD_REG_457_APPS_ADDR A:0x61e04724
y.create.l HWIO_APPS_SMMU_SSD_REG_458_APPS_ADDR A:0x61e04728
y.create.l HWIO_APPS_SMMU_SSD_REG_459_APPS_ADDR A:0x61e0472c
y.create.l HWIO_APPS_SMMU_SSD_REG_460_APPS_ADDR A:0x61e04730
y.create.l HWIO_APPS_SMMU_SSD_REG_461_APPS_ADDR A:0x61e04734
y.create.l HWIO_APPS_SMMU_SSD_REG_462_APPS_ADDR A:0x61e04738
y.create.l HWIO_APPS_SMMU_SSD_REG_463_APPS_ADDR A:0x61e0473c
y.create.l HWIO_APPS_SMMU_SSD_REG_464_APPS_ADDR A:0x61e04740
y.create.l HWIO_APPS_SMMU_SSD_REG_465_APPS_ADDR A:0x61e04744
y.create.l HWIO_APPS_SMMU_SSD_REG_466_APPS_ADDR A:0x61e04748
y.create.l HWIO_APPS_SMMU_SSD_REG_467_APPS_ADDR A:0x61e0474c
y.create.l HWIO_APPS_SMMU_SSD_REG_468_APPS_ADDR A:0x61e04750
y.create.l HWIO_APPS_SMMU_SSD_REG_469_APPS_ADDR A:0x61e04754
y.create.l HWIO_APPS_SMMU_SSD_REG_470_APPS_ADDR A:0x61e04758
y.create.l HWIO_APPS_SMMU_SSD_REG_471_APPS_ADDR A:0x61e0475c
y.create.l HWIO_APPS_SMMU_SSD_REG_472_APPS_ADDR A:0x61e04760
y.create.l HWIO_APPS_SMMU_SSD_REG_473_APPS_ADDR A:0x61e04764
y.create.l HWIO_APPS_SMMU_SSD_REG_474_APPS_ADDR A:0x61e04768
y.create.l HWIO_APPS_SMMU_SSD_REG_475_APPS_ADDR A:0x61e0476c
y.create.l HWIO_APPS_SMMU_SSD_REG_476_APPS_ADDR A:0x61e04770
y.create.l HWIO_APPS_SMMU_SSD_REG_477_APPS_ADDR A:0x61e04774
y.create.l HWIO_APPS_SMMU_SSD_REG_478_APPS_ADDR A:0x61e04778
y.create.l HWIO_APPS_SMMU_SSD_REG_479_APPS_ADDR A:0x61e0477c
y.create.l HWIO_APPS_SMMU_SSD_REG_480_APPS_ADDR A:0x61e04780
y.create.l HWIO_APPS_SMMU_SSD_REG_481_APPS_ADDR A:0x61e04784
y.create.l HWIO_APPS_SMMU_SSD_REG_482_APPS_ADDR A:0x61e04788
y.create.l HWIO_APPS_SMMU_SSD_REG_483_APPS_ADDR A:0x61e0478c
y.create.l HWIO_APPS_SMMU_SSD_REG_484_APPS_ADDR A:0x61e04790
y.create.l HWIO_APPS_SMMU_SSD_REG_485_APPS_ADDR A:0x61e04794
y.create.l HWIO_APPS_SMMU_SSD_REG_486_APPS_ADDR A:0x61e04798
y.create.l HWIO_APPS_SMMU_SSD_REG_487_APPS_ADDR A:0x61e0479c
y.create.l HWIO_APPS_SMMU_SSD_REG_488_APPS_ADDR A:0x61e047a0
y.create.l HWIO_APPS_SMMU_SSD_REG_489_APPS_ADDR A:0x61e047a4
y.create.l HWIO_APPS_SMMU_SSD_REG_490_APPS_ADDR A:0x61e047a8
y.create.l HWIO_APPS_SMMU_SSD_REG_491_APPS_ADDR A:0x61e047ac
y.create.l HWIO_APPS_SMMU_SSD_REG_492_APPS_ADDR A:0x61e047b0
y.create.l HWIO_APPS_SMMU_SSD_REG_493_APPS_ADDR A:0x61e047b4
y.create.l HWIO_APPS_SMMU_SSD_REG_494_APPS_ADDR A:0x61e047b8
y.create.l HWIO_APPS_SMMU_SSD_REG_495_APPS_ADDR A:0x61e047bc
y.create.l HWIO_APPS_SMMU_SSD_REG_496_APPS_ADDR A:0x61e047c0
y.create.l HWIO_APPS_SMMU_SSD_REG_497_APPS_ADDR A:0x61e047c4
y.create.l HWIO_APPS_SMMU_SSD_REG_498_APPS_ADDR A:0x61e047c8
y.create.l HWIO_APPS_SMMU_SSD_REG_499_APPS_ADDR A:0x61e047cc
y.create.l HWIO_APPS_SMMU_SSD_REG_500_APPS_ADDR A:0x61e047d0
y.create.l HWIO_APPS_SMMU_SSD_REG_501_APPS_ADDR A:0x61e047d4
y.create.l HWIO_APPS_SMMU_SSD_REG_502_APPS_ADDR A:0x61e047d8
y.create.l HWIO_APPS_SMMU_SSD_REG_503_APPS_ADDR A:0x61e047dc
y.create.l HWIO_APPS_SMMU_SSD_REG_504_APPS_ADDR A:0x61e047e0
y.create.l HWIO_APPS_SMMU_SSD_REG_505_APPS_ADDR A:0x61e047e4
y.create.l HWIO_APPS_SMMU_SSD_REG_506_APPS_ADDR A:0x61e047e8
y.create.l HWIO_APPS_SMMU_SSD_REG_507_APPS_ADDR A:0x61e047ec
y.create.l HWIO_APPS_SMMU_SSD_REG_508_APPS_ADDR A:0x61e047f0
y.create.l HWIO_APPS_SMMU_SSD_REG_509_APPS_ADDR A:0x61e047f4
y.create.l HWIO_APPS_SMMU_SSD_REG_510_APPS_ADDR A:0x61e047f8
y.create.l HWIO_APPS_SMMU_SSD_REG_511_APPS_ADDR A:0x61e047fc
y.create.l HWIO_APPS_SMMU_SSD_REG_512_APPS_ADDR A:0x61e04800
y.create.l HWIO_APPS_SMMU_SSD_REG_513_APPS_ADDR A:0x61e04804
y.create.l HWIO_APPS_SMMU_SSD_REG_514_APPS_ADDR A:0x61e04808
y.create.l HWIO_APPS_SMMU_SSD_REG_515_APPS_ADDR A:0x61e0480c
y.create.l HWIO_APPS_SMMU_SSD_REG_516_APPS_ADDR A:0x61e04810
y.create.l HWIO_APPS_SMMU_SSD_REG_517_APPS_ADDR A:0x61e04814
y.create.l HWIO_APPS_SMMU_SSD_REG_518_APPS_ADDR A:0x61e04818
y.create.l HWIO_APPS_SMMU_SSD_REG_519_APPS_ADDR A:0x61e0481c
y.create.l HWIO_APPS_SMMU_SSD_REG_520_APPS_ADDR A:0x61e04820
y.create.l HWIO_APPS_SMMU_SSD_REG_521_APPS_ADDR A:0x61e04824
y.create.l HWIO_APPS_SMMU_SSD_REG_522_APPS_ADDR A:0x61e04828
y.create.l HWIO_APPS_SMMU_SSD_REG_523_APPS_ADDR A:0x61e0482c
y.create.l HWIO_APPS_SMMU_SSD_REG_524_APPS_ADDR A:0x61e04830
y.create.l HWIO_APPS_SMMU_SSD_REG_525_APPS_ADDR A:0x61e04834
y.create.l HWIO_APPS_SMMU_SSD_REG_526_APPS_ADDR A:0x61e04838
y.create.l HWIO_APPS_SMMU_SSD_REG_527_APPS_ADDR A:0x61e0483c
y.create.l HWIO_APPS_SMMU_SSD_REG_528_APPS_ADDR A:0x61e04840
y.create.l HWIO_APPS_SMMU_SSD_REG_529_APPS_ADDR A:0x61e04844
y.create.l HWIO_APPS_SMMU_SSD_REG_530_APPS_ADDR A:0x61e04848
y.create.l HWIO_APPS_SMMU_SSD_REG_531_APPS_ADDR A:0x61e0484c
y.create.l HWIO_APPS_SMMU_SSD_REG_532_APPS_ADDR A:0x61e04850
y.create.l HWIO_APPS_SMMU_SSD_REG_533_APPS_ADDR A:0x61e04854
y.create.l HWIO_APPS_SMMU_SSD_REG_534_APPS_ADDR A:0x61e04858
y.create.l HWIO_APPS_SMMU_SSD_REG_535_APPS_ADDR A:0x61e0485c
y.create.l HWIO_APPS_SMMU_SSD_REG_536_APPS_ADDR A:0x61e04860
y.create.l HWIO_APPS_SMMU_SSD_REG_537_APPS_ADDR A:0x61e04864
y.create.l HWIO_APPS_SMMU_SSD_REG_538_APPS_ADDR A:0x61e04868
y.create.l HWIO_APPS_SMMU_SSD_REG_539_APPS_ADDR A:0x61e0486c
y.create.l HWIO_APPS_SMMU_SSD_REG_540_APPS_ADDR A:0x61e04870
y.create.l HWIO_APPS_SMMU_SSD_REG_541_APPS_ADDR A:0x61e04874
y.create.l HWIO_APPS_SMMU_SSD_REG_542_APPS_ADDR A:0x61e04878
y.create.l HWIO_APPS_SMMU_SSD_REG_543_APPS_ADDR A:0x61e0487c
y.create.l HWIO_APPS_SMMU_SSD_REG_544_APPS_ADDR A:0x61e04880
y.create.l HWIO_APPS_SMMU_SSD_REG_545_APPS_ADDR A:0x61e04884
y.create.l HWIO_APPS_SMMU_SSD_REG_546_APPS_ADDR A:0x61e04888
y.create.l HWIO_APPS_SMMU_SSD_REG_547_APPS_ADDR A:0x61e0488c
y.create.l HWIO_APPS_SMMU_SSD_REG_548_APPS_ADDR A:0x61e04890
y.create.l HWIO_APPS_SMMU_SSD_REG_549_APPS_ADDR A:0x61e04894
y.create.l HWIO_APPS_SMMU_SSD_REG_550_APPS_ADDR A:0x61e04898
y.create.l HWIO_APPS_SMMU_SSD_REG_551_APPS_ADDR A:0x61e0489c
y.create.l HWIO_APPS_SMMU_SSD_REG_552_APPS_ADDR A:0x61e048a0
y.create.l HWIO_APPS_SMMU_SSD_REG_553_APPS_ADDR A:0x61e048a4
y.create.l HWIO_APPS_SMMU_SSD_REG_554_APPS_ADDR A:0x61e048a8
y.create.l HWIO_APPS_SMMU_SSD_REG_555_APPS_ADDR A:0x61e048ac
y.create.l HWIO_APPS_SMMU_SSD_REG_556_APPS_ADDR A:0x61e048b0
y.create.l HWIO_APPS_SMMU_SSD_REG_557_APPS_ADDR A:0x61e048b4
y.create.l HWIO_APPS_SMMU_SSD_REG_558_APPS_ADDR A:0x61e048b8
y.create.l HWIO_APPS_SMMU_SSD_REG_559_APPS_ADDR A:0x61e048bc
y.create.l HWIO_APPS_SMMU_SSD_REG_560_APPS_ADDR A:0x61e048c0
y.create.l HWIO_APPS_SMMU_SSD_REG_561_APPS_ADDR A:0x61e048c4
y.create.l HWIO_APPS_SMMU_SSD_REG_562_APPS_ADDR A:0x61e048c8
y.create.l HWIO_APPS_SMMU_SSD_REG_563_APPS_ADDR A:0x61e048cc
y.create.l HWIO_APPS_SMMU_SSD_REG_564_APPS_ADDR A:0x61e048d0
y.create.l HWIO_APPS_SMMU_SSD_REG_565_APPS_ADDR A:0x61e048d4
y.create.l HWIO_APPS_SMMU_SSD_REG_566_APPS_ADDR A:0x61e048d8
y.create.l HWIO_APPS_SMMU_SSD_REG_567_APPS_ADDR A:0x61e048dc
y.create.l HWIO_APPS_SMMU_SSD_REG_568_APPS_ADDR A:0x61e048e0
y.create.l HWIO_APPS_SMMU_SSD_REG_569_APPS_ADDR A:0x61e048e4
y.create.l HWIO_APPS_SMMU_SSD_REG_570_APPS_ADDR A:0x61e048e8
y.create.l HWIO_APPS_SMMU_SSD_REG_571_APPS_ADDR A:0x61e048ec
y.create.l HWIO_APPS_SMMU_SSD_REG_572_APPS_ADDR A:0x61e048f0
y.create.l HWIO_APPS_SMMU_SSD_REG_573_APPS_ADDR A:0x61e048f4
y.create.l HWIO_APPS_SMMU_SSD_REG_574_APPS_ADDR A:0x61e048f8
y.create.l HWIO_APPS_SMMU_SSD_REG_575_APPS_ADDR A:0x61e048fc
y.create.l HWIO_APPS_SMMU_SSD_REG_576_APPS_ADDR A:0x61e04900
y.create.l HWIO_APPS_SMMU_SSD_REG_577_APPS_ADDR A:0x61e04904
y.create.l HWIO_APPS_SMMU_SSD_REG_578_APPS_ADDR A:0x61e04908
y.create.l HWIO_APPS_SMMU_SSD_REG_579_APPS_ADDR A:0x61e0490c
y.create.l HWIO_APPS_SMMU_SSD_REG_580_APPS_ADDR A:0x61e04910
y.create.l HWIO_APPS_SMMU_SSD_REG_581_APPS_ADDR A:0x61e04914
y.create.l HWIO_APPS_SMMU_SSD_REG_582_APPS_ADDR A:0x61e04918
y.create.l HWIO_APPS_SMMU_SSD_REG_583_APPS_ADDR A:0x61e0491c
y.create.l HWIO_APPS_SMMU_SSD_REG_584_APPS_ADDR A:0x61e04920
y.create.l HWIO_APPS_SMMU_SSD_REG_585_APPS_ADDR A:0x61e04924
y.create.l HWIO_APPS_SMMU_SSD_REG_586_APPS_ADDR A:0x61e04928
y.create.l HWIO_APPS_SMMU_SSD_REG_587_APPS_ADDR A:0x61e0492c
y.create.l HWIO_APPS_SMMU_SSD_REG_588_APPS_ADDR A:0x61e04930
y.create.l HWIO_APPS_SMMU_SSD_REG_589_APPS_ADDR A:0x61e04934
y.create.l HWIO_APPS_SMMU_SSD_REG_590_APPS_ADDR A:0x61e04938
y.create.l HWIO_APPS_SMMU_SSD_REG_591_APPS_ADDR A:0x61e0493c
y.create.l HWIO_APPS_SMMU_SSD_REG_592_APPS_ADDR A:0x61e04940
y.create.l HWIO_APPS_SMMU_SSD_REG_593_APPS_ADDR A:0x61e04944
y.create.l HWIO_APPS_SMMU_SSD_REG_594_APPS_ADDR A:0x61e04948
y.create.l HWIO_APPS_SMMU_SSD_REG_595_APPS_ADDR A:0x61e0494c
y.create.l HWIO_APPS_SMMU_SSD_REG_596_APPS_ADDR A:0x61e04950
y.create.l HWIO_APPS_SMMU_SSD_REG_597_APPS_ADDR A:0x61e04954
y.create.l HWIO_APPS_SMMU_SSD_REG_598_APPS_ADDR A:0x61e04958
y.create.l HWIO_APPS_SMMU_SSD_REG_599_APPS_ADDR A:0x61e0495c
y.create.l HWIO_APPS_SMMU_SSD_REG_600_APPS_ADDR A:0x61e04960
y.create.l HWIO_APPS_SMMU_SSD_REG_601_APPS_ADDR A:0x61e04964
y.create.l HWIO_APPS_SMMU_SSD_REG_602_APPS_ADDR A:0x61e04968
y.create.l HWIO_APPS_SMMU_SSD_REG_603_APPS_ADDR A:0x61e0496c
y.create.l HWIO_APPS_SMMU_SSD_REG_604_APPS_ADDR A:0x61e04970
y.create.l HWIO_APPS_SMMU_SSD_REG_605_APPS_ADDR A:0x61e04974
y.create.l HWIO_APPS_SMMU_SSD_REG_606_APPS_ADDR A:0x61e04978
y.create.l HWIO_APPS_SMMU_SSD_REG_607_APPS_ADDR A:0x61e0497c
y.create.l HWIO_APPS_SMMU_SSD_REG_608_APPS_ADDR A:0x61e04980
y.create.l HWIO_APPS_SMMU_SSD_REG_609_APPS_ADDR A:0x61e04984
y.create.l HWIO_APPS_SMMU_SSD_REG_610_APPS_ADDR A:0x61e04988
y.create.l HWIO_APPS_SMMU_SSD_REG_611_APPS_ADDR A:0x61e0498c
y.create.l HWIO_APPS_SMMU_SSD_REG_612_APPS_ADDR A:0x61e04990
y.create.l HWIO_APPS_SMMU_SSD_REG_613_APPS_ADDR A:0x61e04994
y.create.l HWIO_APPS_SMMU_SSD_REG_614_APPS_ADDR A:0x61e04998
y.create.l HWIO_APPS_SMMU_SSD_REG_615_APPS_ADDR A:0x61e0499c
y.create.l HWIO_APPS_SMMU_SSD_REG_616_APPS_ADDR A:0x61e049a0
y.create.l HWIO_APPS_SMMU_SSD_REG_617_APPS_ADDR A:0x61e049a4
y.create.l HWIO_APPS_SMMU_SSD_REG_618_APPS_ADDR A:0x61e049a8
y.create.l HWIO_APPS_SMMU_SSD_REG_619_APPS_ADDR A:0x61e049ac
y.create.l HWIO_APPS_SMMU_SSD_REG_620_APPS_ADDR A:0x61e049b0
y.create.l HWIO_APPS_SMMU_SSD_REG_621_APPS_ADDR A:0x61e049b4
y.create.l HWIO_APPS_SMMU_SSD_REG_622_APPS_ADDR A:0x61e049b8
y.create.l HWIO_APPS_SMMU_SSD_REG_623_APPS_ADDR A:0x61e049bc
y.create.l HWIO_APPS_SMMU_SSD_REG_624_APPS_ADDR A:0x61e049c0
y.create.l HWIO_APPS_SMMU_SSD_REG_625_APPS_ADDR A:0x61e049c4
y.create.l HWIO_APPS_SMMU_SSD_REG_626_APPS_ADDR A:0x61e049c8
y.create.l HWIO_APPS_SMMU_SSD_REG_627_APPS_ADDR A:0x61e049cc
y.create.l HWIO_APPS_SMMU_SSD_REG_628_APPS_ADDR A:0x61e049d0
y.create.l HWIO_APPS_SMMU_SSD_REG_629_APPS_ADDR A:0x61e049d4
y.create.l HWIO_APPS_SMMU_SSD_REG_630_APPS_ADDR A:0x61e049d8
y.create.l HWIO_APPS_SMMU_SSD_REG_631_APPS_ADDR A:0x61e049dc
y.create.l HWIO_APPS_SMMU_SSD_REG_632_APPS_ADDR A:0x61e049e0
y.create.l HWIO_APPS_SMMU_SSD_REG_633_APPS_ADDR A:0x61e049e4
y.create.l HWIO_APPS_SMMU_SSD_REG_634_APPS_ADDR A:0x61e049e8
y.create.l HWIO_APPS_SMMU_SSD_REG_635_APPS_ADDR A:0x61e049ec
y.create.l HWIO_APPS_SMMU_SSD_REG_636_APPS_ADDR A:0x61e049f0
y.create.l HWIO_APPS_SMMU_SSD_REG_637_APPS_ADDR A:0x61e049f4
y.create.l HWIO_APPS_SMMU_SSD_REG_638_APPS_ADDR A:0x61e049f8
y.create.l HWIO_APPS_SMMU_SSD_REG_639_APPS_ADDR A:0x61e049fc
y.create.l HWIO_APPS_SMMU_SSD_REG_640_APPS_ADDR A:0x61e04a00
y.create.l HWIO_APPS_SMMU_SSD_REG_641_APPS_ADDR A:0x61e04a04
y.create.l HWIO_APPS_SMMU_SSD_REG_642_APPS_ADDR A:0x61e04a08
y.create.l HWIO_APPS_SMMU_SSD_REG_643_APPS_ADDR A:0x61e04a0c
y.create.l HWIO_APPS_SMMU_SSD_REG_644_APPS_ADDR A:0x61e04a10
y.create.l HWIO_APPS_SMMU_SSD_REG_645_APPS_ADDR A:0x61e04a14
y.create.l HWIO_APPS_SMMU_SSD_REG_646_APPS_ADDR A:0x61e04a18
y.create.l HWIO_APPS_SMMU_SSD_REG_647_APPS_ADDR A:0x61e04a1c
y.create.l HWIO_APPS_SMMU_SSD_REG_648_APPS_ADDR A:0x61e04a20
y.create.l HWIO_APPS_SMMU_SSD_REG_649_APPS_ADDR A:0x61e04a24
y.create.l HWIO_APPS_SMMU_SSD_REG_650_APPS_ADDR A:0x61e04a28
y.create.l HWIO_APPS_SMMU_SSD_REG_651_APPS_ADDR A:0x61e04a2c
y.create.l HWIO_APPS_SMMU_SSD_REG_652_APPS_ADDR A:0x61e04a30
y.create.l HWIO_APPS_SMMU_SSD_REG_653_APPS_ADDR A:0x61e04a34
y.create.l HWIO_APPS_SMMU_SSD_REG_654_APPS_ADDR A:0x61e04a38
y.create.l HWIO_APPS_SMMU_SSD_REG_655_APPS_ADDR A:0x61e04a3c
y.create.l HWIO_APPS_SMMU_SSD_REG_656_APPS_ADDR A:0x61e04a40
y.create.l HWIO_APPS_SMMU_SSD_REG_657_APPS_ADDR A:0x61e04a44
y.create.l HWIO_APPS_SMMU_SSD_REG_658_APPS_ADDR A:0x61e04a48
y.create.l HWIO_APPS_SMMU_SSD_REG_659_APPS_ADDR A:0x61e04a4c
y.create.l HWIO_APPS_SMMU_SSD_REG_660_APPS_ADDR A:0x61e04a50
y.create.l HWIO_APPS_SMMU_SSD_REG_661_APPS_ADDR A:0x61e04a54
y.create.l HWIO_APPS_SMMU_SSD_REG_662_APPS_ADDR A:0x61e04a58
y.create.l HWIO_APPS_SMMU_SSD_REG_663_APPS_ADDR A:0x61e04a5c
y.create.l HWIO_APPS_SMMU_SSD_REG_664_APPS_ADDR A:0x61e04a60
y.create.l HWIO_APPS_SMMU_SSD_REG_665_APPS_ADDR A:0x61e04a64
y.create.l HWIO_APPS_SMMU_SSD_REG_666_APPS_ADDR A:0x61e04a68
y.create.l HWIO_APPS_SMMU_SSD_REG_667_APPS_ADDR A:0x61e04a6c
y.create.l HWIO_APPS_SMMU_SSD_REG_668_APPS_ADDR A:0x61e04a70
y.create.l HWIO_APPS_SMMU_SSD_REG_669_APPS_ADDR A:0x61e04a74
y.create.l HWIO_APPS_SMMU_SSD_REG_670_APPS_ADDR A:0x61e04a78
y.create.l HWIO_APPS_SMMU_SSD_REG_671_APPS_ADDR A:0x61e04a7c
y.create.l HWIO_APPS_SMMU_SSD_REG_672_APPS_ADDR A:0x61e04a80
y.create.l HWIO_APPS_SMMU_SSD_REG_673_APPS_ADDR A:0x61e04a84
y.create.l HWIO_APPS_SMMU_SSD_REG_674_APPS_ADDR A:0x61e04a88
y.create.l HWIO_APPS_SMMU_SSD_REG_675_APPS_ADDR A:0x61e04a8c
y.create.l HWIO_APPS_SMMU_SSD_REG_676_APPS_ADDR A:0x61e04a90
y.create.l HWIO_APPS_SMMU_SSD_REG_677_APPS_ADDR A:0x61e04a94
y.create.l HWIO_APPS_SMMU_SSD_REG_678_APPS_ADDR A:0x61e04a98
y.create.l HWIO_APPS_SMMU_SSD_REG_679_APPS_ADDR A:0x61e04a9c
y.create.l HWIO_APPS_SMMU_SSD_REG_680_APPS_ADDR A:0x61e04aa0
y.create.l HWIO_APPS_SMMU_SSD_REG_681_APPS_ADDR A:0x61e04aa4
y.create.l HWIO_APPS_SMMU_SSD_REG_682_APPS_ADDR A:0x61e04aa8
y.create.l HWIO_APPS_SMMU_SSD_REG_683_APPS_ADDR A:0x61e04aac
y.create.l HWIO_APPS_SMMU_SSD_REG_684_APPS_ADDR A:0x61e04ab0
y.create.l HWIO_APPS_SMMU_SSD_REG_685_APPS_ADDR A:0x61e04ab4
y.create.l HWIO_APPS_SMMU_SSD_REG_686_APPS_ADDR A:0x61e04ab8
y.create.l HWIO_APPS_SMMU_SSD_REG_687_APPS_ADDR A:0x61e04abc
y.create.l HWIO_APPS_SMMU_SSD_REG_688_APPS_ADDR A:0x61e04ac0
y.create.l HWIO_APPS_SMMU_SSD_REG_689_APPS_ADDR A:0x61e04ac4
y.create.l HWIO_APPS_SMMU_SSD_REG_690_APPS_ADDR A:0x61e04ac8
y.create.l HWIO_APPS_SMMU_SSD_REG_691_APPS_ADDR A:0x61e04acc
y.create.l HWIO_APPS_SMMU_SSD_REG_692_APPS_ADDR A:0x61e04ad0
y.create.l HWIO_APPS_SMMU_SSD_REG_693_APPS_ADDR A:0x61e04ad4
y.create.l HWIO_APPS_SMMU_SSD_REG_694_APPS_ADDR A:0x61e04ad8
y.create.l HWIO_APPS_SMMU_SSD_REG_695_APPS_ADDR A:0x61e04adc
y.create.l HWIO_APPS_SMMU_SSD_REG_696_APPS_ADDR A:0x61e04ae0
y.create.l HWIO_APPS_SMMU_SSD_REG_697_APPS_ADDR A:0x61e04ae4
y.create.l HWIO_APPS_SMMU_SSD_REG_698_APPS_ADDR A:0x61e04ae8
y.create.l HWIO_APPS_SMMU_SSD_REG_699_APPS_ADDR A:0x61e04aec
y.create.l HWIO_APPS_SMMU_SSD_REG_700_APPS_ADDR A:0x61e04af0
y.create.l HWIO_APPS_SMMU_SSD_REG_701_APPS_ADDR A:0x61e04af4
y.create.l HWIO_APPS_SMMU_SSD_REG_702_APPS_ADDR A:0x61e04af8
y.create.l HWIO_APPS_SMMU_SSD_REG_703_APPS_ADDR A:0x61e04afc
y.create.l HWIO_APPS_SMMU_SSD_REG_704_APPS_ADDR A:0x61e04b00
y.create.l HWIO_APPS_SMMU_SSD_REG_705_APPS_ADDR A:0x61e04b04
y.create.l HWIO_APPS_SMMU_SSD_REG_706_APPS_ADDR A:0x61e04b08
y.create.l HWIO_APPS_SMMU_SSD_REG_707_APPS_ADDR A:0x61e04b0c
y.create.l HWIO_APPS_SMMU_SSD_REG_708_APPS_ADDR A:0x61e04b10
y.create.l HWIO_APPS_SMMU_SSD_REG_709_APPS_ADDR A:0x61e04b14
y.create.l HWIO_APPS_SMMU_SSD_REG_710_APPS_ADDR A:0x61e04b18
y.create.l HWIO_APPS_SMMU_SSD_REG_711_APPS_ADDR A:0x61e04b1c
y.create.l HWIO_APPS_SMMU_SSD_REG_712_APPS_ADDR A:0x61e04b20
y.create.l HWIO_APPS_SMMU_SSD_REG_713_APPS_ADDR A:0x61e04b24
y.create.l HWIO_APPS_SMMU_SSD_REG_714_APPS_ADDR A:0x61e04b28
y.create.l HWIO_APPS_SMMU_SSD_REG_715_APPS_ADDR A:0x61e04b2c
y.create.l HWIO_APPS_SMMU_SSD_REG_716_APPS_ADDR A:0x61e04b30
y.create.l HWIO_APPS_SMMU_SSD_REG_717_APPS_ADDR A:0x61e04b34
y.create.l HWIO_APPS_SMMU_SSD_REG_718_APPS_ADDR A:0x61e04b38
y.create.l HWIO_APPS_SMMU_SSD_REG_719_APPS_ADDR A:0x61e04b3c
y.create.l HWIO_APPS_SMMU_SSD_REG_720_APPS_ADDR A:0x61e04b40
y.create.l HWIO_APPS_SMMU_SSD_REG_721_APPS_ADDR A:0x61e04b44
y.create.l HWIO_APPS_SMMU_SSD_REG_722_APPS_ADDR A:0x61e04b48
y.create.l HWIO_APPS_SMMU_SSD_REG_723_APPS_ADDR A:0x61e04b4c
y.create.l HWIO_APPS_SMMU_SSD_REG_724_APPS_ADDR A:0x61e04b50
y.create.l HWIO_APPS_SMMU_SSD_REG_725_APPS_ADDR A:0x61e04b54
y.create.l HWIO_APPS_SMMU_SSD_REG_726_APPS_ADDR A:0x61e04b58
y.create.l HWIO_APPS_SMMU_SSD_REG_727_APPS_ADDR A:0x61e04b5c
y.create.l HWIO_APPS_SMMU_SSD_REG_728_APPS_ADDR A:0x61e04b60
y.create.l HWIO_APPS_SMMU_SSD_REG_729_APPS_ADDR A:0x61e04b64
y.create.l HWIO_APPS_SMMU_SSD_REG_730_APPS_ADDR A:0x61e04b68
y.create.l HWIO_APPS_SMMU_SSD_REG_731_APPS_ADDR A:0x61e04b6c
y.create.l HWIO_APPS_SMMU_SSD_REG_732_APPS_ADDR A:0x61e04b70
y.create.l HWIO_APPS_SMMU_SSD_REG_733_APPS_ADDR A:0x61e04b74
y.create.l HWIO_APPS_SMMU_SSD_REG_734_APPS_ADDR A:0x61e04b78
y.create.l HWIO_APPS_SMMU_SSD_REG_735_APPS_ADDR A:0x61e04b7c
y.create.l HWIO_APPS_SMMU_SSD_REG_736_APPS_ADDR A:0x61e04b80
y.create.l HWIO_APPS_SMMU_SSD_REG_737_APPS_ADDR A:0x61e04b84
y.create.l HWIO_APPS_SMMU_SSD_REG_738_APPS_ADDR A:0x61e04b88
y.create.l HWIO_APPS_SMMU_SSD_REG_739_APPS_ADDR A:0x61e04b8c
y.create.l HWIO_APPS_SMMU_SSD_REG_740_APPS_ADDR A:0x61e04b90
y.create.l HWIO_APPS_SMMU_SSD_REG_741_APPS_ADDR A:0x61e04b94
y.create.l HWIO_APPS_SMMU_SSD_REG_742_APPS_ADDR A:0x61e04b98
y.create.l HWIO_APPS_SMMU_SSD_REG_743_APPS_ADDR A:0x61e04b9c
y.create.l HWIO_APPS_SMMU_SSD_REG_744_APPS_ADDR A:0x61e04ba0
y.create.l HWIO_APPS_SMMU_SSD_REG_745_APPS_ADDR A:0x61e04ba4
y.create.l HWIO_APPS_SMMU_SSD_REG_746_APPS_ADDR A:0x61e04ba8
y.create.l HWIO_APPS_SMMU_SSD_REG_747_APPS_ADDR A:0x61e04bac
y.create.l HWIO_APPS_SMMU_SSD_REG_748_APPS_ADDR A:0x61e04bb0
y.create.l HWIO_APPS_SMMU_SSD_REG_749_APPS_ADDR A:0x61e04bb4
y.create.l HWIO_APPS_SMMU_SSD_REG_750_APPS_ADDR A:0x61e04bb8
y.create.l HWIO_APPS_SMMU_SSD_REG_751_APPS_ADDR A:0x61e04bbc
y.create.l HWIO_APPS_SMMU_SSD_REG_752_APPS_ADDR A:0x61e04bc0
y.create.l HWIO_APPS_SMMU_SSD_REG_753_APPS_ADDR A:0x61e04bc4
y.create.l HWIO_APPS_SMMU_SSD_REG_754_APPS_ADDR A:0x61e04bc8
y.create.l HWIO_APPS_SMMU_SSD_REG_755_APPS_ADDR A:0x61e04bcc
y.create.l HWIO_APPS_SMMU_SSD_REG_756_APPS_ADDR A:0x61e04bd0
y.create.l HWIO_APPS_SMMU_SSD_REG_757_APPS_ADDR A:0x61e04bd4
y.create.l HWIO_APPS_SMMU_SSD_REG_758_APPS_ADDR A:0x61e04bd8
y.create.l HWIO_APPS_SMMU_SSD_REG_759_APPS_ADDR A:0x61e04bdc
y.create.l HWIO_APPS_SMMU_SSD_REG_760_APPS_ADDR A:0x61e04be0
y.create.l HWIO_APPS_SMMU_SSD_REG_761_APPS_ADDR A:0x61e04be4
y.create.l HWIO_APPS_SMMU_SSD_REG_762_APPS_ADDR A:0x61e04be8
y.create.l HWIO_APPS_SMMU_SSD_REG_763_APPS_ADDR A:0x61e04bec
y.create.l HWIO_APPS_SMMU_SSD_REG_764_APPS_ADDR A:0x61e04bf0
y.create.l HWIO_APPS_SMMU_SSD_REG_765_APPS_ADDR A:0x61e04bf4
y.create.l HWIO_APPS_SMMU_SSD_REG_766_APPS_ADDR A:0x61e04bf8
y.create.l HWIO_APPS_SMMU_SSD_REG_767_APPS_ADDR A:0x61e04bfc
y.create.l HWIO_APPS_SMMU_SSD_REG_768_APPS_ADDR A:0x61e04c00
y.create.l HWIO_APPS_SMMU_SSD_REG_769_APPS_ADDR A:0x61e04c04
y.create.l HWIO_APPS_SMMU_SSD_REG_770_APPS_ADDR A:0x61e04c08
y.create.l HWIO_APPS_SMMU_SSD_REG_771_APPS_ADDR A:0x61e04c0c
y.create.l HWIO_APPS_SMMU_SSD_REG_772_APPS_ADDR A:0x61e04c10
y.create.l HWIO_APPS_SMMU_SSD_REG_773_APPS_ADDR A:0x61e04c14
y.create.l HWIO_APPS_SMMU_SSD_REG_774_APPS_ADDR A:0x61e04c18
y.create.l HWIO_APPS_SMMU_SSD_REG_775_APPS_ADDR A:0x61e04c1c
y.create.l HWIO_APPS_SMMU_SSD_REG_776_APPS_ADDR A:0x61e04c20
y.create.l HWIO_APPS_SMMU_SSD_REG_777_APPS_ADDR A:0x61e04c24
y.create.l HWIO_APPS_SMMU_SSD_REG_778_APPS_ADDR A:0x61e04c28
y.create.l HWIO_APPS_SMMU_SSD_REG_779_APPS_ADDR A:0x61e04c2c
y.create.l HWIO_APPS_SMMU_SSD_REG_780_APPS_ADDR A:0x61e04c30
y.create.l HWIO_APPS_SMMU_SSD_REG_781_APPS_ADDR A:0x61e04c34
y.create.l HWIO_APPS_SMMU_SSD_REG_782_APPS_ADDR A:0x61e04c38
y.create.l HWIO_APPS_SMMU_SSD_REG_783_APPS_ADDR A:0x61e04c3c
y.create.l HWIO_APPS_SMMU_SSD_REG_784_APPS_ADDR A:0x61e04c40
y.create.l HWIO_APPS_SMMU_SSD_REG_785_APPS_ADDR A:0x61e04c44
y.create.l HWIO_APPS_SMMU_SSD_REG_786_APPS_ADDR A:0x61e04c48
y.create.l HWIO_APPS_SMMU_SSD_REG_787_APPS_ADDR A:0x61e04c4c
y.create.l HWIO_APPS_SMMU_SSD_REG_788_APPS_ADDR A:0x61e04c50
y.create.l HWIO_APPS_SMMU_SSD_REG_789_APPS_ADDR A:0x61e04c54
y.create.l HWIO_APPS_SMMU_SSD_REG_790_APPS_ADDR A:0x61e04c58
y.create.l HWIO_APPS_SMMU_SSD_REG_791_APPS_ADDR A:0x61e04c5c
y.create.l HWIO_APPS_SMMU_SSD_REG_792_APPS_ADDR A:0x61e04c60
y.create.l HWIO_APPS_SMMU_SSD_REG_793_APPS_ADDR A:0x61e04c64
y.create.l HWIO_APPS_SMMU_SSD_REG_794_APPS_ADDR A:0x61e04c68
y.create.l HWIO_APPS_SMMU_SSD_REG_795_APPS_ADDR A:0x61e04c6c
y.create.l HWIO_APPS_SMMU_SSD_REG_796_APPS_ADDR A:0x61e04c70
y.create.l HWIO_APPS_SMMU_SSD_REG_797_APPS_ADDR A:0x61e04c74
y.create.l HWIO_APPS_SMMU_SSD_REG_798_APPS_ADDR A:0x61e04c78
y.create.l HWIO_APPS_SMMU_SSD_REG_799_APPS_ADDR A:0x61e04c7c
y.create.l HWIO_APPS_SMMU_SSD_REG_800_APPS_ADDR A:0x61e04c80
y.create.l HWIO_APPS_SMMU_SSD_REG_801_APPS_ADDR A:0x61e04c84
y.create.l HWIO_APPS_SMMU_SSD_REG_802_APPS_ADDR A:0x61e04c88
y.create.l HWIO_APPS_SMMU_SSD_REG_803_APPS_ADDR A:0x61e04c8c
y.create.l HWIO_APPS_SMMU_SSD_REG_804_APPS_ADDR A:0x61e04c90
y.create.l HWIO_APPS_SMMU_SSD_REG_805_APPS_ADDR A:0x61e04c94
y.create.l HWIO_APPS_SMMU_SSD_REG_806_APPS_ADDR A:0x61e04c98
y.create.l HWIO_APPS_SMMU_SSD_REG_807_APPS_ADDR A:0x61e04c9c
y.create.l HWIO_APPS_SMMU_SSD_REG_808_APPS_ADDR A:0x61e04ca0
y.create.l HWIO_APPS_SMMU_SSD_REG_809_APPS_ADDR A:0x61e04ca4
y.create.l HWIO_APPS_SMMU_SSD_REG_810_APPS_ADDR A:0x61e04ca8
y.create.l HWIO_APPS_SMMU_SSD_REG_811_APPS_ADDR A:0x61e04cac
y.create.l HWIO_APPS_SMMU_SSD_REG_812_APPS_ADDR A:0x61e04cb0
y.create.l HWIO_APPS_SMMU_SSD_REG_813_APPS_ADDR A:0x61e04cb4
y.create.l HWIO_APPS_SMMU_SSD_REG_814_APPS_ADDR A:0x61e04cb8
y.create.l HWIO_APPS_SMMU_SSD_REG_815_APPS_ADDR A:0x61e04cbc
y.create.l HWIO_APPS_SMMU_SSD_REG_816_APPS_ADDR A:0x61e04cc0
y.create.l HWIO_APPS_SMMU_SSD_REG_817_APPS_ADDR A:0x61e04cc4
y.create.l HWIO_APPS_SMMU_SSD_REG_818_APPS_ADDR A:0x61e04cc8
y.create.l HWIO_APPS_SMMU_SSD_REG_819_APPS_ADDR A:0x61e04ccc
y.create.l HWIO_APPS_SMMU_SSD_REG_820_APPS_ADDR A:0x61e04cd0
y.create.l HWIO_APPS_SMMU_SSD_REG_821_APPS_ADDR A:0x61e04cd4
y.create.l HWIO_APPS_SMMU_SSD_REG_822_APPS_ADDR A:0x61e04cd8
y.create.l HWIO_APPS_SMMU_SSD_REG_823_APPS_ADDR A:0x61e04cdc
y.create.l HWIO_APPS_SMMU_SSD_REG_824_APPS_ADDR A:0x61e04ce0
y.create.l HWIO_APPS_SMMU_SSD_REG_825_APPS_ADDR A:0x61e04ce4
y.create.l HWIO_APPS_SMMU_SSD_REG_826_APPS_ADDR A:0x61e04ce8
y.create.l HWIO_APPS_SMMU_SSD_REG_827_APPS_ADDR A:0x61e04cec
y.create.l HWIO_APPS_SMMU_SSD_REG_828_APPS_ADDR A:0x61e04cf0
y.create.l HWIO_APPS_SMMU_SSD_REG_829_APPS_ADDR A:0x61e04cf4
y.create.l HWIO_APPS_SMMU_SSD_REG_830_APPS_ADDR A:0x61e04cf8
y.create.l HWIO_APPS_SMMU_SSD_REG_831_APPS_ADDR A:0x61e04cfc
y.create.l HWIO_APPS_SMMU_SSD_REG_832_APPS_ADDR A:0x61e04d00
y.create.l HWIO_APPS_SMMU_SSD_REG_833_APPS_ADDR A:0x61e04d04
y.create.l HWIO_APPS_SMMU_SSD_REG_834_APPS_ADDR A:0x61e04d08
y.create.l HWIO_APPS_SMMU_SSD_REG_835_APPS_ADDR A:0x61e04d0c
y.create.l HWIO_APPS_SMMU_SSD_REG_836_APPS_ADDR A:0x61e04d10
y.create.l HWIO_APPS_SMMU_SSD_REG_837_APPS_ADDR A:0x61e04d14
y.create.l HWIO_APPS_SMMU_SSD_REG_838_APPS_ADDR A:0x61e04d18
y.create.l HWIO_APPS_SMMU_SSD_REG_839_APPS_ADDR A:0x61e04d1c
y.create.l HWIO_APPS_SMMU_SSD_REG_840_APPS_ADDR A:0x61e04d20
y.create.l HWIO_APPS_SMMU_SSD_REG_841_APPS_ADDR A:0x61e04d24
y.create.l HWIO_APPS_SMMU_SSD_REG_842_APPS_ADDR A:0x61e04d28
y.create.l HWIO_APPS_SMMU_SSD_REG_843_APPS_ADDR A:0x61e04d2c
y.create.l HWIO_APPS_SMMU_SSD_REG_844_APPS_ADDR A:0x61e04d30
y.create.l HWIO_APPS_SMMU_SSD_REG_845_APPS_ADDR A:0x61e04d34
y.create.l HWIO_APPS_SMMU_SSD_REG_846_APPS_ADDR A:0x61e04d38
y.create.l HWIO_APPS_SMMU_SSD_REG_847_APPS_ADDR A:0x61e04d3c
y.create.l HWIO_APPS_SMMU_SSD_REG_848_APPS_ADDR A:0x61e04d40
y.create.l HWIO_APPS_SMMU_SSD_REG_849_APPS_ADDR A:0x61e04d44
y.create.l HWIO_APPS_SMMU_SSD_REG_850_APPS_ADDR A:0x61e04d48
y.create.l HWIO_APPS_SMMU_SSD_REG_851_APPS_ADDR A:0x61e04d4c
y.create.l HWIO_APPS_SMMU_SSD_REG_852_APPS_ADDR A:0x61e04d50
y.create.l HWIO_APPS_SMMU_SSD_REG_853_APPS_ADDR A:0x61e04d54
y.create.l HWIO_APPS_SMMU_SSD_REG_854_APPS_ADDR A:0x61e04d58
y.create.l HWIO_APPS_SMMU_SSD_REG_855_APPS_ADDR A:0x61e04d5c
y.create.l HWIO_APPS_SMMU_SSD_REG_856_APPS_ADDR A:0x61e04d60
y.create.l HWIO_APPS_SMMU_SSD_REG_857_APPS_ADDR A:0x61e04d64
y.create.l HWIO_APPS_SMMU_SSD_REG_858_APPS_ADDR A:0x61e04d68
y.create.l HWIO_APPS_SMMU_SSD_REG_859_APPS_ADDR A:0x61e04d6c
y.create.l HWIO_APPS_SMMU_SSD_REG_860_APPS_ADDR A:0x61e04d70
y.create.l HWIO_APPS_SMMU_SSD_REG_861_APPS_ADDR A:0x61e04d74
y.create.l HWIO_APPS_SMMU_SSD_REG_862_APPS_ADDR A:0x61e04d78
y.create.l HWIO_APPS_SMMU_SSD_REG_863_APPS_ADDR A:0x61e04d7c
y.create.l HWIO_APPS_SMMU_SSD_REG_864_APPS_ADDR A:0x61e04d80
y.create.l HWIO_APPS_SMMU_SSD_REG_865_APPS_ADDR A:0x61e04d84
y.create.l HWIO_APPS_SMMU_SSD_REG_866_APPS_ADDR A:0x61e04d88
y.create.l HWIO_APPS_SMMU_SSD_REG_867_APPS_ADDR A:0x61e04d8c
y.create.l HWIO_APPS_SMMU_SSD_REG_868_APPS_ADDR A:0x61e04d90
y.create.l HWIO_APPS_SMMU_SSD_REG_869_APPS_ADDR A:0x61e04d94
y.create.l HWIO_APPS_SMMU_SSD_REG_870_APPS_ADDR A:0x61e04d98
y.create.l HWIO_APPS_SMMU_SSD_REG_871_APPS_ADDR A:0x61e04d9c
y.create.l HWIO_APPS_SMMU_SSD_REG_872_APPS_ADDR A:0x61e04da0
y.create.l HWIO_APPS_SMMU_SSD_REG_873_APPS_ADDR A:0x61e04da4
y.create.l HWIO_APPS_SMMU_SSD_REG_874_APPS_ADDR A:0x61e04da8
y.create.l HWIO_APPS_SMMU_SSD_REG_875_APPS_ADDR A:0x61e04dac
y.create.l HWIO_APPS_SMMU_SSD_REG_876_APPS_ADDR A:0x61e04db0
y.create.l HWIO_APPS_SMMU_SSD_REG_877_APPS_ADDR A:0x61e04db4
y.create.l HWIO_APPS_SMMU_SSD_REG_878_APPS_ADDR A:0x61e04db8
y.create.l HWIO_APPS_SMMU_SSD_REG_879_APPS_ADDR A:0x61e04dbc
y.create.l HWIO_APPS_SMMU_SSD_REG_880_APPS_ADDR A:0x61e04dc0
y.create.l HWIO_APPS_SMMU_SSD_REG_881_APPS_ADDR A:0x61e04dc4
y.create.l HWIO_APPS_SMMU_SSD_REG_882_APPS_ADDR A:0x61e04dc8
y.create.l HWIO_APPS_SMMU_SSD_REG_883_APPS_ADDR A:0x61e04dcc
y.create.l HWIO_APPS_SMMU_SSD_REG_884_APPS_ADDR A:0x61e04dd0
y.create.l HWIO_APPS_SMMU_SSD_REG_885_APPS_ADDR A:0x61e04dd4
y.create.l HWIO_APPS_SMMU_SSD_REG_886_APPS_ADDR A:0x61e04dd8
y.create.l HWIO_APPS_SMMU_SSD_REG_887_APPS_ADDR A:0x61e04ddc
y.create.l HWIO_APPS_SMMU_SSD_REG_888_APPS_ADDR A:0x61e04de0
y.create.l HWIO_APPS_SMMU_SSD_REG_889_APPS_ADDR A:0x61e04de4
y.create.l HWIO_APPS_SMMU_SSD_REG_890_APPS_ADDR A:0x61e04de8
y.create.l HWIO_APPS_SMMU_SSD_REG_891_APPS_ADDR A:0x61e04dec
y.create.l HWIO_APPS_SMMU_SSD_REG_892_APPS_ADDR A:0x61e04df0
y.create.l HWIO_APPS_SMMU_SSD_REG_893_APPS_ADDR A:0x61e04df4
y.create.l HWIO_APPS_SMMU_SSD_REG_894_APPS_ADDR A:0x61e04df8
y.create.l HWIO_APPS_SMMU_SSD_REG_895_APPS_ADDR A:0x61e04dfc
y.create.l HWIO_APPS_SMMU_SSD_REG_896_APPS_ADDR A:0x61e04e00
y.create.l HWIO_APPS_SMMU_SSD_REG_897_APPS_ADDR A:0x61e04e04
y.create.l HWIO_APPS_SMMU_SSD_REG_898_APPS_ADDR A:0x61e04e08
y.create.l HWIO_APPS_SMMU_SSD_REG_899_APPS_ADDR A:0x61e04e0c
y.create.l HWIO_APPS_SMMU_SSD_REG_900_APPS_ADDR A:0x61e04e10
y.create.l HWIO_APPS_SMMU_SSD_REG_901_APPS_ADDR A:0x61e04e14
y.create.l HWIO_APPS_SMMU_SSD_REG_902_APPS_ADDR A:0x61e04e18
y.create.l HWIO_APPS_SMMU_SSD_REG_903_APPS_ADDR A:0x61e04e1c
y.create.l HWIO_APPS_SMMU_SSD_REG_904_APPS_ADDR A:0x61e04e20
y.create.l HWIO_APPS_SMMU_SSD_REG_905_APPS_ADDR A:0x61e04e24
y.create.l HWIO_APPS_SMMU_SSD_REG_906_APPS_ADDR A:0x61e04e28
y.create.l HWIO_APPS_SMMU_SSD_REG_907_APPS_ADDR A:0x61e04e2c
y.create.l HWIO_APPS_SMMU_SSD_REG_908_APPS_ADDR A:0x61e04e30
y.create.l HWIO_APPS_SMMU_SSD_REG_909_APPS_ADDR A:0x61e04e34
y.create.l HWIO_APPS_SMMU_SSD_REG_910_APPS_ADDR A:0x61e04e38
y.create.l HWIO_APPS_SMMU_SSD_REG_911_APPS_ADDR A:0x61e04e3c
y.create.l HWIO_APPS_SMMU_SSD_REG_912_APPS_ADDR A:0x61e04e40
y.create.l HWIO_APPS_SMMU_SSD_REG_913_APPS_ADDR A:0x61e04e44
y.create.l HWIO_APPS_SMMU_SSD_REG_914_APPS_ADDR A:0x61e04e48
y.create.l HWIO_APPS_SMMU_SSD_REG_915_APPS_ADDR A:0x61e04e4c
y.create.l HWIO_APPS_SMMU_SSD_REG_916_APPS_ADDR A:0x61e04e50
y.create.l HWIO_APPS_SMMU_SSD_REG_917_APPS_ADDR A:0x61e04e54
y.create.l HWIO_APPS_SMMU_SSD_REG_918_APPS_ADDR A:0x61e04e58
y.create.l HWIO_APPS_SMMU_SSD_REG_919_APPS_ADDR A:0x61e04e5c
y.create.l HWIO_APPS_SMMU_SSD_REG_920_APPS_ADDR A:0x61e04e60
y.create.l HWIO_APPS_SMMU_SSD_REG_921_APPS_ADDR A:0x61e04e64
y.create.l HWIO_APPS_SMMU_SSD_REG_922_APPS_ADDR A:0x61e04e68
y.create.l HWIO_APPS_SMMU_SSD_REG_923_APPS_ADDR A:0x61e04e6c
y.create.l HWIO_APPS_SMMU_SSD_REG_924_APPS_ADDR A:0x61e04e70
y.create.l HWIO_APPS_SMMU_SSD_REG_925_APPS_ADDR A:0x61e04e74
y.create.l HWIO_APPS_SMMU_SSD_REG_926_APPS_ADDR A:0x61e04e78
y.create.l HWIO_APPS_SMMU_SSD_REG_927_APPS_ADDR A:0x61e04e7c
y.create.l HWIO_APPS_SMMU_SSD_REG_928_APPS_ADDR A:0x61e04e80
y.create.l HWIO_APPS_SMMU_SSD_REG_929_APPS_ADDR A:0x61e04e84
y.create.l HWIO_APPS_SMMU_SSD_REG_930_APPS_ADDR A:0x61e04e88
y.create.l HWIO_APPS_SMMU_SSD_REG_931_APPS_ADDR A:0x61e04e8c
y.create.l HWIO_APPS_SMMU_SSD_REG_932_APPS_ADDR A:0x61e04e90
y.create.l HWIO_APPS_SMMU_SSD_REG_933_APPS_ADDR A:0x61e04e94
y.create.l HWIO_APPS_SMMU_SSD_REG_934_APPS_ADDR A:0x61e04e98
y.create.l HWIO_APPS_SMMU_SSD_REG_935_APPS_ADDR A:0x61e04e9c
y.create.l HWIO_APPS_SMMU_SSD_REG_936_APPS_ADDR A:0x61e04ea0
y.create.l HWIO_APPS_SMMU_SSD_REG_937_APPS_ADDR A:0x61e04ea4
y.create.l HWIO_APPS_SMMU_SSD_REG_938_APPS_ADDR A:0x61e04ea8
y.create.l HWIO_APPS_SMMU_SSD_REG_939_APPS_ADDR A:0x61e04eac
y.create.l HWIO_APPS_SMMU_SSD_REG_940_APPS_ADDR A:0x61e04eb0
y.create.l HWIO_APPS_SMMU_SSD_REG_941_APPS_ADDR A:0x61e04eb4
y.create.l HWIO_APPS_SMMU_SSD_REG_942_APPS_ADDR A:0x61e04eb8
y.create.l HWIO_APPS_SMMU_SSD_REG_943_APPS_ADDR A:0x61e04ebc
y.create.l HWIO_APPS_SMMU_SSD_REG_944_APPS_ADDR A:0x61e04ec0
y.create.l HWIO_APPS_SMMU_SSD_REG_945_APPS_ADDR A:0x61e04ec4
y.create.l HWIO_APPS_SMMU_SSD_REG_946_APPS_ADDR A:0x61e04ec8
y.create.l HWIO_APPS_SMMU_SSD_REG_947_APPS_ADDR A:0x61e04ecc
y.create.l HWIO_APPS_SMMU_SSD_REG_948_APPS_ADDR A:0x61e04ed0
y.create.l HWIO_APPS_SMMU_SSD_REG_949_APPS_ADDR A:0x61e04ed4
y.create.l HWIO_APPS_SMMU_SSD_REG_950_APPS_ADDR A:0x61e04ed8
y.create.l HWIO_APPS_SMMU_SSD_REG_951_APPS_ADDR A:0x61e04edc
y.create.l HWIO_APPS_SMMU_SSD_REG_952_APPS_ADDR A:0x61e04ee0
y.create.l HWIO_APPS_SMMU_SSD_REG_953_APPS_ADDR A:0x61e04ee4
y.create.l HWIO_APPS_SMMU_SSD_REG_954_APPS_ADDR A:0x61e04ee8
y.create.l HWIO_APPS_SMMU_SSD_REG_955_APPS_ADDR A:0x61e04eec
y.create.l HWIO_APPS_SMMU_SSD_REG_956_APPS_ADDR A:0x61e04ef0
y.create.l HWIO_APPS_SMMU_SSD_REG_957_APPS_ADDR A:0x61e04ef4
y.create.l HWIO_APPS_SMMU_SSD_REG_958_APPS_ADDR A:0x61e04ef8
y.create.l HWIO_APPS_SMMU_SSD_REG_959_APPS_ADDR A:0x61e04efc
y.create.l HWIO_APPS_SMMU_SSD_REG_960_APPS_ADDR A:0x61e04f00
y.create.l HWIO_APPS_SMMU_SSD_REG_961_APPS_ADDR A:0x61e04f04
y.create.l HWIO_APPS_SMMU_SSD_REG_962_APPS_ADDR A:0x61e04f08
y.create.l HWIO_APPS_SMMU_SSD_REG_963_APPS_ADDR A:0x61e04f0c
y.create.l HWIO_APPS_SMMU_SSD_REG_964_APPS_ADDR A:0x61e04f10
y.create.l HWIO_APPS_SMMU_SSD_REG_965_APPS_ADDR A:0x61e04f14
y.create.l HWIO_APPS_SMMU_SSD_REG_966_APPS_ADDR A:0x61e04f18
y.create.l HWIO_APPS_SMMU_SSD_REG_967_APPS_ADDR A:0x61e04f1c
y.create.l HWIO_APPS_SMMU_SSD_REG_968_APPS_ADDR A:0x61e04f20
y.create.l HWIO_APPS_SMMU_SSD_REG_969_APPS_ADDR A:0x61e04f24
y.create.l HWIO_APPS_SMMU_SSD_REG_970_APPS_ADDR A:0x61e04f28
y.create.l HWIO_APPS_SMMU_SSD_REG_971_APPS_ADDR A:0x61e04f2c
y.create.l HWIO_APPS_SMMU_SSD_REG_972_APPS_ADDR A:0x61e04f30
y.create.l HWIO_APPS_SMMU_SSD_REG_973_APPS_ADDR A:0x61e04f34
y.create.l HWIO_APPS_SMMU_SSD_REG_974_APPS_ADDR A:0x61e04f38
y.create.l HWIO_APPS_SMMU_SSD_REG_975_APPS_ADDR A:0x61e04f3c
y.create.l HWIO_APPS_SMMU_SSD_REG_976_APPS_ADDR A:0x61e04f40
y.create.l HWIO_APPS_SMMU_SSD_REG_977_APPS_ADDR A:0x61e04f44
y.create.l HWIO_APPS_SMMU_SSD_REG_978_APPS_ADDR A:0x61e04f48
y.create.l HWIO_APPS_SMMU_SSD_REG_979_APPS_ADDR A:0x61e04f4c
y.create.l HWIO_APPS_SMMU_SSD_REG_980_APPS_ADDR A:0x61e04f50
y.create.l HWIO_APPS_SMMU_SSD_REG_981_APPS_ADDR A:0x61e04f54
y.create.l HWIO_APPS_SMMU_SSD_REG_982_APPS_ADDR A:0x61e04f58
y.create.l HWIO_APPS_SMMU_SSD_REG_983_APPS_ADDR A:0x61e04f5c
y.create.l HWIO_APPS_SMMU_SSD_REG_984_APPS_ADDR A:0x61e04f60
y.create.l HWIO_APPS_SMMU_SSD_REG_985_APPS_ADDR A:0x61e04f64
y.create.l HWIO_APPS_SMMU_SSD_REG_986_APPS_ADDR A:0x61e04f68
y.create.l HWIO_APPS_SMMU_SSD_REG_987_APPS_ADDR A:0x61e04f6c
y.create.l HWIO_APPS_SMMU_SSD_REG_988_APPS_ADDR A:0x61e04f70
y.create.l HWIO_APPS_SMMU_SSD_REG_989_APPS_ADDR A:0x61e04f74
y.create.l HWIO_APPS_SMMU_SSD_REG_990_APPS_ADDR A:0x61e04f78
y.create.l HWIO_APPS_SMMU_SSD_REG_991_APPS_ADDR A:0x61e04f7c
y.create.l HWIO_APPS_SMMU_SSD_REG_992_APPS_ADDR A:0x61e04f80
y.create.l HWIO_APPS_SMMU_SSD_REG_993_APPS_ADDR A:0x61e04f84
y.create.l HWIO_APPS_SMMU_SSD_REG_994_APPS_ADDR A:0x61e04f88
y.create.l HWIO_APPS_SMMU_SSD_REG_995_APPS_ADDR A:0x61e04f8c
y.create.l HWIO_APPS_SMMU_SSD_REG_996_APPS_ADDR A:0x61e04f90
y.create.l HWIO_APPS_SMMU_SSD_REG_997_APPS_ADDR A:0x61e04f94
y.create.l HWIO_APPS_SMMU_SSD_REG_998_APPS_ADDR A:0x61e04f98
y.create.l HWIO_APPS_SMMU_SSD_REG_999_APPS_ADDR A:0x61e04f9c
y.create.l HWIO_APPS_SMMU_SSD_REG_1000_APPS_ADDR A:0x61e04fa0
y.create.l HWIO_APPS_SMMU_SSD_REG_1001_APPS_ADDR A:0x61e04fa4
y.create.l HWIO_APPS_SMMU_SSD_REG_1002_APPS_ADDR A:0x61e04fa8
y.create.l HWIO_APPS_SMMU_SSD_REG_1003_APPS_ADDR A:0x61e04fac
y.create.l HWIO_APPS_SMMU_SSD_REG_1004_APPS_ADDR A:0x61e04fb0
y.create.l HWIO_APPS_SMMU_SSD_REG_1005_APPS_ADDR A:0x61e04fb4
y.create.l HWIO_APPS_SMMU_SSD_REG_1006_APPS_ADDR A:0x61e04fb8
y.create.l HWIO_APPS_SMMU_SSD_REG_1007_APPS_ADDR A:0x61e04fbc
y.create.l HWIO_APPS_SMMU_SSD_REG_1008_APPS_ADDR A:0x61e04fc0
y.create.l HWIO_APPS_SMMU_SSD_REG_1009_APPS_ADDR A:0x61e04fc4
y.create.l HWIO_APPS_SMMU_SSD_REG_1010_APPS_ADDR A:0x61e04fc8
y.create.l HWIO_APPS_SMMU_SSD_REG_1011_APPS_ADDR A:0x61e04fcc
y.create.l HWIO_APPS_SMMU_SSD_REG_1012_APPS_ADDR A:0x61e04fd0
y.create.l HWIO_APPS_SMMU_SSD_REG_1013_APPS_ADDR A:0x61e04fd4
y.create.l HWIO_APPS_SMMU_SSD_REG_1014_APPS_ADDR A:0x61e04fd8
y.create.l HWIO_APPS_SMMU_SSD_REG_1015_APPS_ADDR A:0x61e04fdc
y.create.l HWIO_APPS_SMMU_SSD_REG_1016_APPS_ADDR A:0x61e04fe0
y.create.l HWIO_APPS_SMMU_SSD_REG_1017_APPS_ADDR A:0x61e04fe4
y.create.l HWIO_APPS_SMMU_SSD_REG_1018_APPS_ADDR A:0x61e04fe8
y.create.l HWIO_APPS_SMMU_SSD_REG_1019_APPS_ADDR A:0x61e04fec
y.create.l HWIO_APPS_SMMU_SSD_REG_1020_APPS_ADDR A:0x61e04ff0
y.create.l HWIO_APPS_SMMU_SSD_REG_1021_APPS_ADDR A:0x61e04ff4
y.create.l HWIO_APPS_SMMU_SSD_REG_1022_APPS_ADDR A:0x61e04ff8
y.create.l HWIO_APPS_SMMU_SSD_REG_1023_APPS_ADDR A:0x61e04ffc
y.create.l HWIO_APPS_SMMU_CB0_SCTLR_APPS_ADDR A:0x61e20000
y.create.l HWIO_APPS_SMMU_CB1_SCTLR_APPS_ADDR A:0x61e21000
y.create.l HWIO_APPS_SMMU_CB2_SCTLR_APPS_ADDR A:0x61e22000
y.create.l HWIO_APPS_SMMU_CB3_SCTLR_APPS_ADDR A:0x61e23000
y.create.l HWIO_APPS_SMMU_CB4_SCTLR_APPS_ADDR A:0x61e24000
y.create.l HWIO_APPS_SMMU_CB5_SCTLR_APPS_ADDR A:0x61e25000
y.create.l HWIO_APPS_SMMU_CB6_SCTLR_APPS_ADDR A:0x61e26000
y.create.l HWIO_APPS_SMMU_CB7_SCTLR_APPS_ADDR A:0x61e27000
y.create.l HWIO_APPS_SMMU_CB8_SCTLR_APPS_ADDR A:0x61e28000
y.create.l HWIO_APPS_SMMU_CB9_SCTLR_APPS_ADDR A:0x61e29000
y.create.l HWIO_APPS_SMMU_CB10_SCTLR_APPS_ADDR A:0x61e2a000
y.create.l HWIO_APPS_SMMU_CB11_SCTLR_APPS_ADDR A:0x61e2b000
y.create.l HWIO_APPS_SMMU_CB12_SCTLR_APPS_ADDR A:0x61e2c000
y.create.l HWIO_APPS_SMMU_CB13_SCTLR_APPS_ADDR A:0x61e2d000
y.create.l HWIO_APPS_SMMU_CB14_SCTLR_APPS_ADDR A:0x61e2e000
y.create.l HWIO_APPS_SMMU_CB15_SCTLR_APPS_ADDR A:0x61e2f000
y.create.l HWIO_APPS_SMMU_CB16_SCTLR_APPS_ADDR A:0x61e30000
y.create.l HWIO_APPS_SMMU_CB17_SCTLR_APPS_ADDR A:0x61e31000
y.create.l HWIO_APPS_SMMU_CB18_SCTLR_APPS_ADDR A:0x61e32000
y.create.l HWIO_APPS_SMMU_CB19_SCTLR_APPS_ADDR A:0x61e33000
y.create.l HWIO_APPS_SMMU_CB20_SCTLR_APPS_ADDR A:0x61e34000
y.create.l HWIO_APPS_SMMU_CB21_SCTLR_APPS_ADDR A:0x61e35000
y.create.l HWIO_APPS_SMMU_CB22_SCTLR_APPS_ADDR A:0x61e36000
y.create.l HWIO_APPS_SMMU_CB23_SCTLR_APPS_ADDR A:0x61e37000
y.create.l HWIO_APPS_SMMU_CB24_SCTLR_APPS_ADDR A:0x61e38000
y.create.l HWIO_APPS_SMMU_CB25_SCTLR_APPS_ADDR A:0x61e39000
y.create.l HWIO_APPS_SMMU_CB26_SCTLR_APPS_ADDR A:0x61e3a000
y.create.l HWIO_APPS_SMMU_CB27_SCTLR_APPS_ADDR A:0x61e3b000
y.create.l HWIO_APPS_SMMU_CB28_SCTLR_APPS_ADDR A:0x61e3c000
y.create.l HWIO_APPS_SMMU_CB29_SCTLR_APPS_ADDR A:0x61e3d000
y.create.l HWIO_APPS_SMMU_CB30_SCTLR_APPS_ADDR A:0x61e3e000
y.create.l HWIO_APPS_SMMU_CB31_SCTLR_APPS_ADDR A:0x61e3f000
y.create.l HWIO_APPS_SMMU_CB0_ACTLR_APPS_ADDR A:0x61e20004
y.create.l HWIO_APPS_SMMU_CB1_ACTLR_APPS_ADDR A:0x61e21004
y.create.l HWIO_APPS_SMMU_CB2_ACTLR_APPS_ADDR A:0x61e22004
y.create.l HWIO_APPS_SMMU_CB3_ACTLR_APPS_ADDR A:0x61e23004
y.create.l HWIO_APPS_SMMU_CB4_ACTLR_APPS_ADDR A:0x61e24004
y.create.l HWIO_APPS_SMMU_CB5_ACTLR_APPS_ADDR A:0x61e25004
y.create.l HWIO_APPS_SMMU_CB6_ACTLR_APPS_ADDR A:0x61e26004
y.create.l HWIO_APPS_SMMU_CB7_ACTLR_APPS_ADDR A:0x61e27004
y.create.l HWIO_APPS_SMMU_CB8_ACTLR_APPS_ADDR A:0x61e28004
y.create.l HWIO_APPS_SMMU_CB9_ACTLR_APPS_ADDR A:0x61e29004
y.create.l HWIO_APPS_SMMU_CB10_ACTLR_APPS_ADDR A:0x61e2a004
y.create.l HWIO_APPS_SMMU_CB11_ACTLR_APPS_ADDR A:0x61e2b004
y.create.l HWIO_APPS_SMMU_CB12_ACTLR_APPS_ADDR A:0x61e2c004
y.create.l HWIO_APPS_SMMU_CB13_ACTLR_APPS_ADDR A:0x61e2d004
y.create.l HWIO_APPS_SMMU_CB14_ACTLR_APPS_ADDR A:0x61e2e004
y.create.l HWIO_APPS_SMMU_CB15_ACTLR_APPS_ADDR A:0x61e2f004
y.create.l HWIO_APPS_SMMU_CB16_ACTLR_APPS_ADDR A:0x61e30004
y.create.l HWIO_APPS_SMMU_CB17_ACTLR_APPS_ADDR A:0x61e31004
y.create.l HWIO_APPS_SMMU_CB18_ACTLR_APPS_ADDR A:0x61e32004
y.create.l HWIO_APPS_SMMU_CB19_ACTLR_APPS_ADDR A:0x61e33004
y.create.l HWIO_APPS_SMMU_CB20_ACTLR_APPS_ADDR A:0x61e34004
y.create.l HWIO_APPS_SMMU_CB21_ACTLR_APPS_ADDR A:0x61e35004
y.create.l HWIO_APPS_SMMU_CB22_ACTLR_APPS_ADDR A:0x61e36004
y.create.l HWIO_APPS_SMMU_CB23_ACTLR_APPS_ADDR A:0x61e37004
y.create.l HWIO_APPS_SMMU_CB24_ACTLR_APPS_ADDR A:0x61e38004
y.create.l HWIO_APPS_SMMU_CB25_ACTLR_APPS_ADDR A:0x61e39004
y.create.l HWIO_APPS_SMMU_CB26_ACTLR_APPS_ADDR A:0x61e3a004
y.create.l HWIO_APPS_SMMU_CB27_ACTLR_APPS_ADDR A:0x61e3b004
y.create.l HWIO_APPS_SMMU_CB28_ACTLR_APPS_ADDR A:0x61e3c004
y.create.l HWIO_APPS_SMMU_CB29_ACTLR_APPS_ADDR A:0x61e3d004
y.create.l HWIO_APPS_SMMU_CB30_ACTLR_APPS_ADDR A:0x61e3e004
y.create.l HWIO_APPS_SMMU_CB31_ACTLR_APPS_ADDR A:0x61e3f004
y.create.l HWIO_APPS_SMMU_CB0_RESUME_APPS_ADDR A:0x61e20008
y.create.l HWIO_APPS_SMMU_CB1_RESUME_APPS_ADDR A:0x61e21008
y.create.l HWIO_APPS_SMMU_CB2_RESUME_APPS_ADDR A:0x61e22008
y.create.l HWIO_APPS_SMMU_CB3_RESUME_APPS_ADDR A:0x61e23008
y.create.l HWIO_APPS_SMMU_CB4_RESUME_APPS_ADDR A:0x61e24008
y.create.l HWIO_APPS_SMMU_CB5_RESUME_APPS_ADDR A:0x61e25008
y.create.l HWIO_APPS_SMMU_CB6_RESUME_APPS_ADDR A:0x61e26008
y.create.l HWIO_APPS_SMMU_CB7_RESUME_APPS_ADDR A:0x61e27008
y.create.l HWIO_APPS_SMMU_CB8_RESUME_APPS_ADDR A:0x61e28008
y.create.l HWIO_APPS_SMMU_CB9_RESUME_APPS_ADDR A:0x61e29008
y.create.l HWIO_APPS_SMMU_CB10_RESUME_APPS_ADDR A:0x61e2a008
y.create.l HWIO_APPS_SMMU_CB11_RESUME_APPS_ADDR A:0x61e2b008
y.create.l HWIO_APPS_SMMU_CB12_RESUME_APPS_ADDR A:0x61e2c008
y.create.l HWIO_APPS_SMMU_CB13_RESUME_APPS_ADDR A:0x61e2d008
y.create.l HWIO_APPS_SMMU_CB14_RESUME_APPS_ADDR A:0x61e2e008
y.create.l HWIO_APPS_SMMU_CB15_RESUME_APPS_ADDR A:0x61e2f008
y.create.l HWIO_APPS_SMMU_CB16_RESUME_APPS_ADDR A:0x61e30008
y.create.l HWIO_APPS_SMMU_CB17_RESUME_APPS_ADDR A:0x61e31008
y.create.l HWIO_APPS_SMMU_CB18_RESUME_APPS_ADDR A:0x61e32008
y.create.l HWIO_APPS_SMMU_CB19_RESUME_APPS_ADDR A:0x61e33008
y.create.l HWIO_APPS_SMMU_CB20_RESUME_APPS_ADDR A:0x61e34008
y.create.l HWIO_APPS_SMMU_CB21_RESUME_APPS_ADDR A:0x61e35008
y.create.l HWIO_APPS_SMMU_CB22_RESUME_APPS_ADDR A:0x61e36008
y.create.l HWIO_APPS_SMMU_CB23_RESUME_APPS_ADDR A:0x61e37008
y.create.l HWIO_APPS_SMMU_CB24_RESUME_APPS_ADDR A:0x61e38008
y.create.l HWIO_APPS_SMMU_CB25_RESUME_APPS_ADDR A:0x61e39008
y.create.l HWIO_APPS_SMMU_CB26_RESUME_APPS_ADDR A:0x61e3a008
y.create.l HWIO_APPS_SMMU_CB27_RESUME_APPS_ADDR A:0x61e3b008
y.create.l HWIO_APPS_SMMU_CB28_RESUME_APPS_ADDR A:0x61e3c008
y.create.l HWIO_APPS_SMMU_CB29_RESUME_APPS_ADDR A:0x61e3d008
y.create.l HWIO_APPS_SMMU_CB30_RESUME_APPS_ADDR A:0x61e3e008
y.create.l HWIO_APPS_SMMU_CB31_RESUME_APPS_ADDR A:0x61e3f008
y.create.l HWIO_APPS_SMMU_CB0_TCR2_APPS_ADDR A:0x61e20010
y.create.l HWIO_APPS_SMMU_CB1_TCR2_APPS_ADDR A:0x61e21010
y.create.l HWIO_APPS_SMMU_CB2_TCR2_APPS_ADDR A:0x61e22010
y.create.l HWIO_APPS_SMMU_CB3_TCR2_APPS_ADDR A:0x61e23010
y.create.l HWIO_APPS_SMMU_CB4_TCR2_APPS_ADDR A:0x61e24010
y.create.l HWIO_APPS_SMMU_CB5_TCR2_APPS_ADDR A:0x61e25010
y.create.l HWIO_APPS_SMMU_CB6_TCR2_APPS_ADDR A:0x61e26010
y.create.l HWIO_APPS_SMMU_CB7_TCR2_APPS_ADDR A:0x61e27010
y.create.l HWIO_APPS_SMMU_CB8_TCR2_APPS_ADDR A:0x61e28010
y.create.l HWIO_APPS_SMMU_CB9_TCR2_APPS_ADDR A:0x61e29010
y.create.l HWIO_APPS_SMMU_CB10_TCR2_APPS_ADDR A:0x61e2a010
y.create.l HWIO_APPS_SMMU_CB11_TCR2_APPS_ADDR A:0x61e2b010
y.create.l HWIO_APPS_SMMU_CB12_TCR2_APPS_ADDR A:0x61e2c010
y.create.l HWIO_APPS_SMMU_CB13_TCR2_APPS_ADDR A:0x61e2d010
y.create.l HWIO_APPS_SMMU_CB14_TCR2_APPS_ADDR A:0x61e2e010
y.create.l HWIO_APPS_SMMU_CB15_TCR2_APPS_ADDR A:0x61e2f010
y.create.l HWIO_APPS_SMMU_CB16_TCR2_APPS_ADDR A:0x61e30010
y.create.l HWIO_APPS_SMMU_CB17_TCR2_APPS_ADDR A:0x61e31010
y.create.l HWIO_APPS_SMMU_CB18_TCR2_APPS_ADDR A:0x61e32010
y.create.l HWIO_APPS_SMMU_CB19_TCR2_APPS_ADDR A:0x61e33010
y.create.l HWIO_APPS_SMMU_CB20_TCR2_APPS_ADDR A:0x61e34010
y.create.l HWIO_APPS_SMMU_CB21_TCR2_APPS_ADDR A:0x61e35010
y.create.l HWIO_APPS_SMMU_CB22_TCR2_APPS_ADDR A:0x61e36010
y.create.l HWIO_APPS_SMMU_CB23_TCR2_APPS_ADDR A:0x61e37010
y.create.l HWIO_APPS_SMMU_CB24_TCR2_APPS_ADDR A:0x61e38010
y.create.l HWIO_APPS_SMMU_CB25_TCR2_APPS_ADDR A:0x61e39010
y.create.l HWIO_APPS_SMMU_CB26_TCR2_APPS_ADDR A:0x61e3a010
y.create.l HWIO_APPS_SMMU_CB27_TCR2_APPS_ADDR A:0x61e3b010
y.create.l HWIO_APPS_SMMU_CB28_TCR2_APPS_ADDR A:0x61e3c010
y.create.l HWIO_APPS_SMMU_CB29_TCR2_APPS_ADDR A:0x61e3d010
y.create.l HWIO_APPS_SMMU_CB30_TCR2_APPS_ADDR A:0x61e3e010
y.create.l HWIO_APPS_SMMU_CB31_TCR2_APPS_ADDR A:0x61e3f010
y.create.l HWIO_APPS_SMMU_CB0_TTBR0_LOW_APPS_ADDR A:0x61e20020
y.create.l HWIO_APPS_SMMU_CB1_TTBR0_LOW_APPS_ADDR A:0x61e21020
y.create.l HWIO_APPS_SMMU_CB2_TTBR0_LOW_APPS_ADDR A:0x61e22020
y.create.l HWIO_APPS_SMMU_CB3_TTBR0_LOW_APPS_ADDR A:0x61e23020
y.create.l HWIO_APPS_SMMU_CB4_TTBR0_LOW_APPS_ADDR A:0x61e24020
y.create.l HWIO_APPS_SMMU_CB5_TTBR0_LOW_APPS_ADDR A:0x61e25020
y.create.l HWIO_APPS_SMMU_CB6_TTBR0_LOW_APPS_ADDR A:0x61e26020
y.create.l HWIO_APPS_SMMU_CB7_TTBR0_LOW_APPS_ADDR A:0x61e27020
y.create.l HWIO_APPS_SMMU_CB8_TTBR0_LOW_APPS_ADDR A:0x61e28020
y.create.l HWIO_APPS_SMMU_CB9_TTBR0_LOW_APPS_ADDR A:0x61e29020
y.create.l HWIO_APPS_SMMU_CB10_TTBR0_LOW_APPS_ADDR A:0x61e2a020
y.create.l HWIO_APPS_SMMU_CB11_TTBR0_LOW_APPS_ADDR A:0x61e2b020
y.create.l HWIO_APPS_SMMU_CB12_TTBR0_LOW_APPS_ADDR A:0x61e2c020
y.create.l HWIO_APPS_SMMU_CB13_TTBR0_LOW_APPS_ADDR A:0x61e2d020
y.create.l HWIO_APPS_SMMU_CB14_TTBR0_LOW_APPS_ADDR A:0x61e2e020
y.create.l HWIO_APPS_SMMU_CB15_TTBR0_LOW_APPS_ADDR A:0x61e2f020
y.create.l HWIO_APPS_SMMU_CB16_TTBR0_LOW_APPS_ADDR A:0x61e30020
y.create.l HWIO_APPS_SMMU_CB17_TTBR0_LOW_APPS_ADDR A:0x61e31020
y.create.l HWIO_APPS_SMMU_CB18_TTBR0_LOW_APPS_ADDR A:0x61e32020
y.create.l HWIO_APPS_SMMU_CB19_TTBR0_LOW_APPS_ADDR A:0x61e33020
y.create.l HWIO_APPS_SMMU_CB20_TTBR0_LOW_APPS_ADDR A:0x61e34020
y.create.l HWIO_APPS_SMMU_CB21_TTBR0_LOW_APPS_ADDR A:0x61e35020
y.create.l HWIO_APPS_SMMU_CB22_TTBR0_LOW_APPS_ADDR A:0x61e36020
y.create.l HWIO_APPS_SMMU_CB23_TTBR0_LOW_APPS_ADDR A:0x61e37020
y.create.l HWIO_APPS_SMMU_CB24_TTBR0_LOW_APPS_ADDR A:0x61e38020
y.create.l HWIO_APPS_SMMU_CB25_TTBR0_LOW_APPS_ADDR A:0x61e39020
y.create.l HWIO_APPS_SMMU_CB26_TTBR0_LOW_APPS_ADDR A:0x61e3a020
y.create.l HWIO_APPS_SMMU_CB27_TTBR0_LOW_APPS_ADDR A:0x61e3b020
y.create.l HWIO_APPS_SMMU_CB28_TTBR0_LOW_APPS_ADDR A:0x61e3c020
y.create.l HWIO_APPS_SMMU_CB29_TTBR0_LOW_APPS_ADDR A:0x61e3d020
y.create.l HWIO_APPS_SMMU_CB30_TTBR0_LOW_APPS_ADDR A:0x61e3e020
y.create.l HWIO_APPS_SMMU_CB31_TTBR0_LOW_APPS_ADDR A:0x61e3f020
y.create.l HWIO_APPS_SMMU_CB0_TTBR0_HIGH_APPS_ADDR A:0x61e20024
y.create.l HWIO_APPS_SMMU_CB1_TTBR0_HIGH_APPS_ADDR A:0x61e21024
y.create.l HWIO_APPS_SMMU_CB2_TTBR0_HIGH_APPS_ADDR A:0x61e22024
y.create.l HWIO_APPS_SMMU_CB3_TTBR0_HIGH_APPS_ADDR A:0x61e23024
y.create.l HWIO_APPS_SMMU_CB4_TTBR0_HIGH_APPS_ADDR A:0x61e24024
y.create.l HWIO_APPS_SMMU_CB5_TTBR0_HIGH_APPS_ADDR A:0x61e25024
y.create.l HWIO_APPS_SMMU_CB6_TTBR0_HIGH_APPS_ADDR A:0x61e26024
y.create.l HWIO_APPS_SMMU_CB7_TTBR0_HIGH_APPS_ADDR A:0x61e27024
y.create.l HWIO_APPS_SMMU_CB8_TTBR0_HIGH_APPS_ADDR A:0x61e28024
y.create.l HWIO_APPS_SMMU_CB9_TTBR0_HIGH_APPS_ADDR A:0x61e29024
y.create.l HWIO_APPS_SMMU_CB10_TTBR0_HIGH_APPS_ADDR A:0x61e2a024
y.create.l HWIO_APPS_SMMU_CB11_TTBR0_HIGH_APPS_ADDR A:0x61e2b024
y.create.l HWIO_APPS_SMMU_CB12_TTBR0_HIGH_APPS_ADDR A:0x61e2c024
y.create.l HWIO_APPS_SMMU_CB13_TTBR0_HIGH_APPS_ADDR A:0x61e2d024
y.create.l HWIO_APPS_SMMU_CB14_TTBR0_HIGH_APPS_ADDR A:0x61e2e024
y.create.l HWIO_APPS_SMMU_CB15_TTBR0_HIGH_APPS_ADDR A:0x61e2f024
y.create.l HWIO_APPS_SMMU_CB16_TTBR0_HIGH_APPS_ADDR A:0x61e30024
y.create.l HWIO_APPS_SMMU_CB17_TTBR0_HIGH_APPS_ADDR A:0x61e31024
y.create.l HWIO_APPS_SMMU_CB18_TTBR0_HIGH_APPS_ADDR A:0x61e32024
y.create.l HWIO_APPS_SMMU_CB19_TTBR0_HIGH_APPS_ADDR A:0x61e33024
y.create.l HWIO_APPS_SMMU_CB20_TTBR0_HIGH_APPS_ADDR A:0x61e34024
y.create.l HWIO_APPS_SMMU_CB21_TTBR0_HIGH_APPS_ADDR A:0x61e35024
y.create.l HWIO_APPS_SMMU_CB22_TTBR0_HIGH_APPS_ADDR A:0x61e36024
y.create.l HWIO_APPS_SMMU_CB23_TTBR0_HIGH_APPS_ADDR A:0x61e37024
y.create.l HWIO_APPS_SMMU_CB24_TTBR0_HIGH_APPS_ADDR A:0x61e38024
y.create.l HWIO_APPS_SMMU_CB25_TTBR0_HIGH_APPS_ADDR A:0x61e39024
y.create.l HWIO_APPS_SMMU_CB26_TTBR0_HIGH_APPS_ADDR A:0x61e3a024
y.create.l HWIO_APPS_SMMU_CB27_TTBR0_HIGH_APPS_ADDR A:0x61e3b024
y.create.l HWIO_APPS_SMMU_CB28_TTBR0_HIGH_APPS_ADDR A:0x61e3c024
y.create.l HWIO_APPS_SMMU_CB29_TTBR0_HIGH_APPS_ADDR A:0x61e3d024
y.create.l HWIO_APPS_SMMU_CB30_TTBR0_HIGH_APPS_ADDR A:0x61e3e024
y.create.l HWIO_APPS_SMMU_CB31_TTBR0_HIGH_APPS_ADDR A:0x61e3f024
y.create.l HWIO_APPS_SMMU_CB0_TTBR1_LOW_APPS_ADDR A:0x61e20028
y.create.l HWIO_APPS_SMMU_CB1_TTBR1_LOW_APPS_ADDR A:0x61e21028
y.create.l HWIO_APPS_SMMU_CB2_TTBR1_LOW_APPS_ADDR A:0x61e22028
y.create.l HWIO_APPS_SMMU_CB3_TTBR1_LOW_APPS_ADDR A:0x61e23028
y.create.l HWIO_APPS_SMMU_CB4_TTBR1_LOW_APPS_ADDR A:0x61e24028
y.create.l HWIO_APPS_SMMU_CB5_TTBR1_LOW_APPS_ADDR A:0x61e25028
y.create.l HWIO_APPS_SMMU_CB6_TTBR1_LOW_APPS_ADDR A:0x61e26028
y.create.l HWIO_APPS_SMMU_CB7_TTBR1_LOW_APPS_ADDR A:0x61e27028
y.create.l HWIO_APPS_SMMU_CB8_TTBR1_LOW_APPS_ADDR A:0x61e28028
y.create.l HWIO_APPS_SMMU_CB9_TTBR1_LOW_APPS_ADDR A:0x61e29028
y.create.l HWIO_APPS_SMMU_CB10_TTBR1_LOW_APPS_ADDR A:0x61e2a028
y.create.l HWIO_APPS_SMMU_CB11_TTBR1_LOW_APPS_ADDR A:0x61e2b028
y.create.l HWIO_APPS_SMMU_CB12_TTBR1_LOW_APPS_ADDR A:0x61e2c028
y.create.l HWIO_APPS_SMMU_CB13_TTBR1_LOW_APPS_ADDR A:0x61e2d028
y.create.l HWIO_APPS_SMMU_CB14_TTBR1_LOW_APPS_ADDR A:0x61e2e028
y.create.l HWIO_APPS_SMMU_CB15_TTBR1_LOW_APPS_ADDR A:0x61e2f028
y.create.l HWIO_APPS_SMMU_CB16_TTBR1_LOW_APPS_ADDR A:0x61e30028
y.create.l HWIO_APPS_SMMU_CB17_TTBR1_LOW_APPS_ADDR A:0x61e31028
y.create.l HWIO_APPS_SMMU_CB18_TTBR1_LOW_APPS_ADDR A:0x61e32028
y.create.l HWIO_APPS_SMMU_CB19_TTBR1_LOW_APPS_ADDR A:0x61e33028
y.create.l HWIO_APPS_SMMU_CB20_TTBR1_LOW_APPS_ADDR A:0x61e34028
y.create.l HWIO_APPS_SMMU_CB21_TTBR1_LOW_APPS_ADDR A:0x61e35028
y.create.l HWIO_APPS_SMMU_CB22_TTBR1_LOW_APPS_ADDR A:0x61e36028
y.create.l HWIO_APPS_SMMU_CB23_TTBR1_LOW_APPS_ADDR A:0x61e37028
y.create.l HWIO_APPS_SMMU_CB24_TTBR1_LOW_APPS_ADDR A:0x61e38028
y.create.l HWIO_APPS_SMMU_CB25_TTBR1_LOW_APPS_ADDR A:0x61e39028
y.create.l HWIO_APPS_SMMU_CB26_TTBR1_LOW_APPS_ADDR A:0x61e3a028
y.create.l HWIO_APPS_SMMU_CB27_TTBR1_LOW_APPS_ADDR A:0x61e3b028
y.create.l HWIO_APPS_SMMU_CB28_TTBR1_LOW_APPS_ADDR A:0x61e3c028
y.create.l HWIO_APPS_SMMU_CB29_TTBR1_LOW_APPS_ADDR A:0x61e3d028
y.create.l HWIO_APPS_SMMU_CB30_TTBR1_LOW_APPS_ADDR A:0x61e3e028
y.create.l HWIO_APPS_SMMU_CB31_TTBR1_LOW_APPS_ADDR A:0x61e3f028
y.create.l HWIO_APPS_SMMU_CB0_TTBR1_HIGH_APPS_ADDR A:0x61e2002c
y.create.l HWIO_APPS_SMMU_CB1_TTBR1_HIGH_APPS_ADDR A:0x61e2102c
y.create.l HWIO_APPS_SMMU_CB2_TTBR1_HIGH_APPS_ADDR A:0x61e2202c
y.create.l HWIO_APPS_SMMU_CB3_TTBR1_HIGH_APPS_ADDR A:0x61e2302c
y.create.l HWIO_APPS_SMMU_CB4_TTBR1_HIGH_APPS_ADDR A:0x61e2402c
y.create.l HWIO_APPS_SMMU_CB5_TTBR1_HIGH_APPS_ADDR A:0x61e2502c
y.create.l HWIO_APPS_SMMU_CB6_TTBR1_HIGH_APPS_ADDR A:0x61e2602c
y.create.l HWIO_APPS_SMMU_CB7_TTBR1_HIGH_APPS_ADDR A:0x61e2702c
y.create.l HWIO_APPS_SMMU_CB8_TTBR1_HIGH_APPS_ADDR A:0x61e2802c
y.create.l HWIO_APPS_SMMU_CB9_TTBR1_HIGH_APPS_ADDR A:0x61e2902c
y.create.l HWIO_APPS_SMMU_CB10_TTBR1_HIGH_APPS_ADDR A:0x61e2a02c
y.create.l HWIO_APPS_SMMU_CB11_TTBR1_HIGH_APPS_ADDR A:0x61e2b02c
y.create.l HWIO_APPS_SMMU_CB12_TTBR1_HIGH_APPS_ADDR A:0x61e2c02c
y.create.l HWIO_APPS_SMMU_CB13_TTBR1_HIGH_APPS_ADDR A:0x61e2d02c
y.create.l HWIO_APPS_SMMU_CB14_TTBR1_HIGH_APPS_ADDR A:0x61e2e02c
y.create.l HWIO_APPS_SMMU_CB15_TTBR1_HIGH_APPS_ADDR A:0x61e2f02c
y.create.l HWIO_APPS_SMMU_CB16_TTBR1_HIGH_APPS_ADDR A:0x61e3002c
y.create.l HWIO_APPS_SMMU_CB17_TTBR1_HIGH_APPS_ADDR A:0x61e3102c
y.create.l HWIO_APPS_SMMU_CB18_TTBR1_HIGH_APPS_ADDR A:0x61e3202c
y.create.l HWIO_APPS_SMMU_CB19_TTBR1_HIGH_APPS_ADDR A:0x61e3302c
y.create.l HWIO_APPS_SMMU_CB20_TTBR1_HIGH_APPS_ADDR A:0x61e3402c
y.create.l HWIO_APPS_SMMU_CB21_TTBR1_HIGH_APPS_ADDR A:0x61e3502c
y.create.l HWIO_APPS_SMMU_CB22_TTBR1_HIGH_APPS_ADDR A:0x61e3602c
y.create.l HWIO_APPS_SMMU_CB23_TTBR1_HIGH_APPS_ADDR A:0x61e3702c
y.create.l HWIO_APPS_SMMU_CB24_TTBR1_HIGH_APPS_ADDR A:0x61e3802c
y.create.l HWIO_APPS_SMMU_CB25_TTBR1_HIGH_APPS_ADDR A:0x61e3902c
y.create.l HWIO_APPS_SMMU_CB26_TTBR1_HIGH_APPS_ADDR A:0x61e3a02c
y.create.l HWIO_APPS_SMMU_CB27_TTBR1_HIGH_APPS_ADDR A:0x61e3b02c
y.create.l HWIO_APPS_SMMU_CB28_TTBR1_HIGH_APPS_ADDR A:0x61e3c02c
y.create.l HWIO_APPS_SMMU_CB29_TTBR1_HIGH_APPS_ADDR A:0x61e3d02c
y.create.l HWIO_APPS_SMMU_CB30_TTBR1_HIGH_APPS_ADDR A:0x61e3e02c
y.create.l HWIO_APPS_SMMU_CB31_TTBR1_HIGH_APPS_ADDR A:0x61e3f02c
y.create.l HWIO_APPS_SMMU_CB0_TCR_LPAE_APPS_ADDR A:0x61e20030
y.create.l HWIO_APPS_SMMU_CB1_TCR_LPAE_APPS_ADDR A:0x61e21030
y.create.l HWIO_APPS_SMMU_CB2_TCR_LPAE_APPS_ADDR A:0x61e22030
y.create.l HWIO_APPS_SMMU_CB3_TCR_LPAE_APPS_ADDR A:0x61e23030
y.create.l HWIO_APPS_SMMU_CB4_TCR_LPAE_APPS_ADDR A:0x61e24030
y.create.l HWIO_APPS_SMMU_CB5_TCR_LPAE_APPS_ADDR A:0x61e25030
y.create.l HWIO_APPS_SMMU_CB6_TCR_LPAE_APPS_ADDR A:0x61e26030
y.create.l HWIO_APPS_SMMU_CB7_TCR_LPAE_APPS_ADDR A:0x61e27030
y.create.l HWIO_APPS_SMMU_CB8_TCR_LPAE_APPS_ADDR A:0x61e28030
y.create.l HWIO_APPS_SMMU_CB9_TCR_LPAE_APPS_ADDR A:0x61e29030
y.create.l HWIO_APPS_SMMU_CB10_TCR_LPAE_APPS_ADDR A:0x61e2a030
y.create.l HWIO_APPS_SMMU_CB11_TCR_LPAE_APPS_ADDR A:0x61e2b030
y.create.l HWIO_APPS_SMMU_CB12_TCR_LPAE_APPS_ADDR A:0x61e2c030
y.create.l HWIO_APPS_SMMU_CB13_TCR_LPAE_APPS_ADDR A:0x61e2d030
y.create.l HWIO_APPS_SMMU_CB14_TCR_LPAE_APPS_ADDR A:0x61e2e030
y.create.l HWIO_APPS_SMMU_CB15_TCR_LPAE_APPS_ADDR A:0x61e2f030
y.create.l HWIO_APPS_SMMU_CB16_TCR_LPAE_APPS_ADDR A:0x61e30030
y.create.l HWIO_APPS_SMMU_CB17_TCR_LPAE_APPS_ADDR A:0x61e31030
y.create.l HWIO_APPS_SMMU_CB18_TCR_LPAE_APPS_ADDR A:0x61e32030
y.create.l HWIO_APPS_SMMU_CB19_TCR_LPAE_APPS_ADDR A:0x61e33030
y.create.l HWIO_APPS_SMMU_CB20_TCR_LPAE_APPS_ADDR A:0x61e34030
y.create.l HWIO_APPS_SMMU_CB21_TCR_LPAE_APPS_ADDR A:0x61e35030
y.create.l HWIO_APPS_SMMU_CB22_TCR_LPAE_APPS_ADDR A:0x61e36030
y.create.l HWIO_APPS_SMMU_CB23_TCR_LPAE_APPS_ADDR A:0x61e37030
y.create.l HWIO_APPS_SMMU_CB24_TCR_LPAE_APPS_ADDR A:0x61e38030
y.create.l HWIO_APPS_SMMU_CB25_TCR_LPAE_APPS_ADDR A:0x61e39030
y.create.l HWIO_APPS_SMMU_CB26_TCR_LPAE_APPS_ADDR A:0x61e3a030
y.create.l HWIO_APPS_SMMU_CB27_TCR_LPAE_APPS_ADDR A:0x61e3b030
y.create.l HWIO_APPS_SMMU_CB28_TCR_LPAE_APPS_ADDR A:0x61e3c030
y.create.l HWIO_APPS_SMMU_CB29_TCR_LPAE_APPS_ADDR A:0x61e3d030
y.create.l HWIO_APPS_SMMU_CB30_TCR_LPAE_APPS_ADDR A:0x61e3e030
y.create.l HWIO_APPS_SMMU_CB31_TCR_LPAE_APPS_ADDR A:0x61e3f030
y.create.l HWIO_APPS_SMMU_CB0_CONTEXTIDR_APPS_ADDR A:0x61e20034
y.create.l HWIO_APPS_SMMU_CB1_CONTEXTIDR_APPS_ADDR A:0x61e21034
y.create.l HWIO_APPS_SMMU_CB2_CONTEXTIDR_APPS_ADDR A:0x61e22034
y.create.l HWIO_APPS_SMMU_CB3_CONTEXTIDR_APPS_ADDR A:0x61e23034
y.create.l HWIO_APPS_SMMU_CB4_CONTEXTIDR_APPS_ADDR A:0x61e24034
y.create.l HWIO_APPS_SMMU_CB5_CONTEXTIDR_APPS_ADDR A:0x61e25034
y.create.l HWIO_APPS_SMMU_CB6_CONTEXTIDR_APPS_ADDR A:0x61e26034
y.create.l HWIO_APPS_SMMU_CB7_CONTEXTIDR_APPS_ADDR A:0x61e27034
y.create.l HWIO_APPS_SMMU_CB8_CONTEXTIDR_APPS_ADDR A:0x61e28034
y.create.l HWIO_APPS_SMMU_CB9_CONTEXTIDR_APPS_ADDR A:0x61e29034
y.create.l HWIO_APPS_SMMU_CB10_CONTEXTIDR_APPS_ADDR A:0x61e2a034
y.create.l HWIO_APPS_SMMU_CB11_CONTEXTIDR_APPS_ADDR A:0x61e2b034
y.create.l HWIO_APPS_SMMU_CB12_CONTEXTIDR_APPS_ADDR A:0x61e2c034
y.create.l HWIO_APPS_SMMU_CB13_CONTEXTIDR_APPS_ADDR A:0x61e2d034
y.create.l HWIO_APPS_SMMU_CB14_CONTEXTIDR_APPS_ADDR A:0x61e2e034
y.create.l HWIO_APPS_SMMU_CB15_CONTEXTIDR_APPS_ADDR A:0x61e2f034
y.create.l HWIO_APPS_SMMU_CB16_CONTEXTIDR_APPS_ADDR A:0x61e30034
y.create.l HWIO_APPS_SMMU_CB17_CONTEXTIDR_APPS_ADDR A:0x61e31034
y.create.l HWIO_APPS_SMMU_CB18_CONTEXTIDR_APPS_ADDR A:0x61e32034
y.create.l HWIO_APPS_SMMU_CB19_CONTEXTIDR_APPS_ADDR A:0x61e33034
y.create.l HWIO_APPS_SMMU_CB20_CONTEXTIDR_APPS_ADDR A:0x61e34034
y.create.l HWIO_APPS_SMMU_CB21_CONTEXTIDR_APPS_ADDR A:0x61e35034
y.create.l HWIO_APPS_SMMU_CB22_CONTEXTIDR_APPS_ADDR A:0x61e36034
y.create.l HWIO_APPS_SMMU_CB23_CONTEXTIDR_APPS_ADDR A:0x61e37034
y.create.l HWIO_APPS_SMMU_CB24_CONTEXTIDR_APPS_ADDR A:0x61e38034
y.create.l HWIO_APPS_SMMU_CB25_CONTEXTIDR_APPS_ADDR A:0x61e39034
y.create.l HWIO_APPS_SMMU_CB26_CONTEXTIDR_APPS_ADDR A:0x61e3a034
y.create.l HWIO_APPS_SMMU_CB27_CONTEXTIDR_APPS_ADDR A:0x61e3b034
y.create.l HWIO_APPS_SMMU_CB28_CONTEXTIDR_APPS_ADDR A:0x61e3c034
y.create.l HWIO_APPS_SMMU_CB29_CONTEXTIDR_APPS_ADDR A:0x61e3d034
y.create.l HWIO_APPS_SMMU_CB30_CONTEXTIDR_APPS_ADDR A:0x61e3e034
y.create.l HWIO_APPS_SMMU_CB31_CONTEXTIDR_APPS_ADDR A:0x61e3f034
y.create.l HWIO_APPS_SMMU_CB0_PRRR_MAIR0_APPS_ADDR A:0x61e20038
y.create.l HWIO_APPS_SMMU_CB1_PRRR_MAIR0_APPS_ADDR A:0x61e21038
y.create.l HWIO_APPS_SMMU_CB2_PRRR_MAIR0_APPS_ADDR A:0x61e22038
y.create.l HWIO_APPS_SMMU_CB3_PRRR_MAIR0_APPS_ADDR A:0x61e23038
y.create.l HWIO_APPS_SMMU_CB4_PRRR_MAIR0_APPS_ADDR A:0x61e24038
y.create.l HWIO_APPS_SMMU_CB5_PRRR_MAIR0_APPS_ADDR A:0x61e25038
y.create.l HWIO_APPS_SMMU_CB6_PRRR_MAIR0_APPS_ADDR A:0x61e26038
y.create.l HWIO_APPS_SMMU_CB7_PRRR_MAIR0_APPS_ADDR A:0x61e27038
y.create.l HWIO_APPS_SMMU_CB8_PRRR_MAIR0_APPS_ADDR A:0x61e28038
y.create.l HWIO_APPS_SMMU_CB9_PRRR_MAIR0_APPS_ADDR A:0x61e29038
y.create.l HWIO_APPS_SMMU_CB10_PRRR_MAIR0_APPS_ADDR A:0x61e2a038
y.create.l HWIO_APPS_SMMU_CB11_PRRR_MAIR0_APPS_ADDR A:0x61e2b038
y.create.l HWIO_APPS_SMMU_CB12_PRRR_MAIR0_APPS_ADDR A:0x61e2c038
y.create.l HWIO_APPS_SMMU_CB13_PRRR_MAIR0_APPS_ADDR A:0x61e2d038
y.create.l HWIO_APPS_SMMU_CB14_PRRR_MAIR0_APPS_ADDR A:0x61e2e038
y.create.l HWIO_APPS_SMMU_CB15_PRRR_MAIR0_APPS_ADDR A:0x61e2f038
y.create.l HWIO_APPS_SMMU_CB16_PRRR_MAIR0_APPS_ADDR A:0x61e30038
y.create.l HWIO_APPS_SMMU_CB17_PRRR_MAIR0_APPS_ADDR A:0x61e31038
y.create.l HWIO_APPS_SMMU_CB18_PRRR_MAIR0_APPS_ADDR A:0x61e32038
y.create.l HWIO_APPS_SMMU_CB19_PRRR_MAIR0_APPS_ADDR A:0x61e33038
y.create.l HWIO_APPS_SMMU_CB20_PRRR_MAIR0_APPS_ADDR A:0x61e34038
y.create.l HWIO_APPS_SMMU_CB21_PRRR_MAIR0_APPS_ADDR A:0x61e35038
y.create.l HWIO_APPS_SMMU_CB22_PRRR_MAIR0_APPS_ADDR A:0x61e36038
y.create.l HWIO_APPS_SMMU_CB23_PRRR_MAIR0_APPS_ADDR A:0x61e37038
y.create.l HWIO_APPS_SMMU_CB24_PRRR_MAIR0_APPS_ADDR A:0x61e38038
y.create.l HWIO_APPS_SMMU_CB25_PRRR_MAIR0_APPS_ADDR A:0x61e39038
y.create.l HWIO_APPS_SMMU_CB26_PRRR_MAIR0_APPS_ADDR A:0x61e3a038
y.create.l HWIO_APPS_SMMU_CB27_PRRR_MAIR0_APPS_ADDR A:0x61e3b038
y.create.l HWIO_APPS_SMMU_CB28_PRRR_MAIR0_APPS_ADDR A:0x61e3c038
y.create.l HWIO_APPS_SMMU_CB29_PRRR_MAIR0_APPS_ADDR A:0x61e3d038
y.create.l HWIO_APPS_SMMU_CB30_PRRR_MAIR0_APPS_ADDR A:0x61e3e038
y.create.l HWIO_APPS_SMMU_CB31_PRRR_MAIR0_APPS_ADDR A:0x61e3f038
y.create.l HWIO_APPS_SMMU_CB0_NMRR_MAIR1_APPS_ADDR A:0x61e2003c
y.create.l HWIO_APPS_SMMU_CB1_NMRR_MAIR1_APPS_ADDR A:0x61e2103c
y.create.l HWIO_APPS_SMMU_CB2_NMRR_MAIR1_APPS_ADDR A:0x61e2203c
y.create.l HWIO_APPS_SMMU_CB3_NMRR_MAIR1_APPS_ADDR A:0x61e2303c
y.create.l HWIO_APPS_SMMU_CB4_NMRR_MAIR1_APPS_ADDR A:0x61e2403c
y.create.l HWIO_APPS_SMMU_CB5_NMRR_MAIR1_APPS_ADDR A:0x61e2503c
y.create.l HWIO_APPS_SMMU_CB6_NMRR_MAIR1_APPS_ADDR A:0x61e2603c
y.create.l HWIO_APPS_SMMU_CB7_NMRR_MAIR1_APPS_ADDR A:0x61e2703c
y.create.l HWIO_APPS_SMMU_CB8_NMRR_MAIR1_APPS_ADDR A:0x61e2803c
y.create.l HWIO_APPS_SMMU_CB9_NMRR_MAIR1_APPS_ADDR A:0x61e2903c
y.create.l HWIO_APPS_SMMU_CB10_NMRR_MAIR1_APPS_ADDR A:0x61e2a03c
y.create.l HWIO_APPS_SMMU_CB11_NMRR_MAIR1_APPS_ADDR A:0x61e2b03c
y.create.l HWIO_APPS_SMMU_CB12_NMRR_MAIR1_APPS_ADDR A:0x61e2c03c
y.create.l HWIO_APPS_SMMU_CB13_NMRR_MAIR1_APPS_ADDR A:0x61e2d03c
y.create.l HWIO_APPS_SMMU_CB14_NMRR_MAIR1_APPS_ADDR A:0x61e2e03c
y.create.l HWIO_APPS_SMMU_CB15_NMRR_MAIR1_APPS_ADDR A:0x61e2f03c
y.create.l HWIO_APPS_SMMU_CB16_NMRR_MAIR1_APPS_ADDR A:0x61e3003c
y.create.l HWIO_APPS_SMMU_CB17_NMRR_MAIR1_APPS_ADDR A:0x61e3103c
y.create.l HWIO_APPS_SMMU_CB18_NMRR_MAIR1_APPS_ADDR A:0x61e3203c
y.create.l HWIO_APPS_SMMU_CB19_NMRR_MAIR1_APPS_ADDR A:0x61e3303c
y.create.l HWIO_APPS_SMMU_CB20_NMRR_MAIR1_APPS_ADDR A:0x61e3403c
y.create.l HWIO_APPS_SMMU_CB21_NMRR_MAIR1_APPS_ADDR A:0x61e3503c
y.create.l HWIO_APPS_SMMU_CB22_NMRR_MAIR1_APPS_ADDR A:0x61e3603c
y.create.l HWIO_APPS_SMMU_CB23_NMRR_MAIR1_APPS_ADDR A:0x61e3703c
y.create.l HWIO_APPS_SMMU_CB24_NMRR_MAIR1_APPS_ADDR A:0x61e3803c
y.create.l HWIO_APPS_SMMU_CB25_NMRR_MAIR1_APPS_ADDR A:0x61e3903c
y.create.l HWIO_APPS_SMMU_CB26_NMRR_MAIR1_APPS_ADDR A:0x61e3a03c
y.create.l HWIO_APPS_SMMU_CB27_NMRR_MAIR1_APPS_ADDR A:0x61e3b03c
y.create.l HWIO_APPS_SMMU_CB28_NMRR_MAIR1_APPS_ADDR A:0x61e3c03c
y.create.l HWIO_APPS_SMMU_CB29_NMRR_MAIR1_APPS_ADDR A:0x61e3d03c
y.create.l HWIO_APPS_SMMU_CB30_NMRR_MAIR1_APPS_ADDR A:0x61e3e03c
y.create.l HWIO_APPS_SMMU_CB31_NMRR_MAIR1_APPS_ADDR A:0x61e3f03c
y.create.l HWIO_APPS_SMMU_CB0_FSR_APPS_ADDR A:0x61e20058
y.create.l HWIO_APPS_SMMU_CB1_FSR_APPS_ADDR A:0x61e21058
y.create.l HWIO_APPS_SMMU_CB2_FSR_APPS_ADDR A:0x61e22058
y.create.l HWIO_APPS_SMMU_CB3_FSR_APPS_ADDR A:0x61e23058
y.create.l HWIO_APPS_SMMU_CB4_FSR_APPS_ADDR A:0x61e24058
y.create.l HWIO_APPS_SMMU_CB5_FSR_APPS_ADDR A:0x61e25058
y.create.l HWIO_APPS_SMMU_CB6_FSR_APPS_ADDR A:0x61e26058
y.create.l HWIO_APPS_SMMU_CB7_FSR_APPS_ADDR A:0x61e27058
y.create.l HWIO_APPS_SMMU_CB8_FSR_APPS_ADDR A:0x61e28058
y.create.l HWIO_APPS_SMMU_CB9_FSR_APPS_ADDR A:0x61e29058
y.create.l HWIO_APPS_SMMU_CB10_FSR_APPS_ADDR A:0x61e2a058
y.create.l HWIO_APPS_SMMU_CB11_FSR_APPS_ADDR A:0x61e2b058
y.create.l HWIO_APPS_SMMU_CB12_FSR_APPS_ADDR A:0x61e2c058
y.create.l HWIO_APPS_SMMU_CB13_FSR_APPS_ADDR A:0x61e2d058
y.create.l HWIO_APPS_SMMU_CB14_FSR_APPS_ADDR A:0x61e2e058
y.create.l HWIO_APPS_SMMU_CB15_FSR_APPS_ADDR A:0x61e2f058
y.create.l HWIO_APPS_SMMU_CB16_FSR_APPS_ADDR A:0x61e30058
y.create.l HWIO_APPS_SMMU_CB17_FSR_APPS_ADDR A:0x61e31058
y.create.l HWIO_APPS_SMMU_CB18_FSR_APPS_ADDR A:0x61e32058
y.create.l HWIO_APPS_SMMU_CB19_FSR_APPS_ADDR A:0x61e33058
y.create.l HWIO_APPS_SMMU_CB20_FSR_APPS_ADDR A:0x61e34058
y.create.l HWIO_APPS_SMMU_CB21_FSR_APPS_ADDR A:0x61e35058
y.create.l HWIO_APPS_SMMU_CB22_FSR_APPS_ADDR A:0x61e36058
y.create.l HWIO_APPS_SMMU_CB23_FSR_APPS_ADDR A:0x61e37058
y.create.l HWIO_APPS_SMMU_CB24_FSR_APPS_ADDR A:0x61e38058
y.create.l HWIO_APPS_SMMU_CB25_FSR_APPS_ADDR A:0x61e39058
y.create.l HWIO_APPS_SMMU_CB26_FSR_APPS_ADDR A:0x61e3a058
y.create.l HWIO_APPS_SMMU_CB27_FSR_APPS_ADDR A:0x61e3b058
y.create.l HWIO_APPS_SMMU_CB28_FSR_APPS_ADDR A:0x61e3c058
y.create.l HWIO_APPS_SMMU_CB29_FSR_APPS_ADDR A:0x61e3d058
y.create.l HWIO_APPS_SMMU_CB30_FSR_APPS_ADDR A:0x61e3e058
y.create.l HWIO_APPS_SMMU_CB31_FSR_APPS_ADDR A:0x61e3f058
y.create.l HWIO_APPS_SMMU_CB0_FSRRESTORE_APPS_ADDR A:0x61e2005c
y.create.l HWIO_APPS_SMMU_CB1_FSRRESTORE_APPS_ADDR A:0x61e2105c
y.create.l HWIO_APPS_SMMU_CB2_FSRRESTORE_APPS_ADDR A:0x61e2205c
y.create.l HWIO_APPS_SMMU_CB3_FSRRESTORE_APPS_ADDR A:0x61e2305c
y.create.l HWIO_APPS_SMMU_CB4_FSRRESTORE_APPS_ADDR A:0x61e2405c
y.create.l HWIO_APPS_SMMU_CB5_FSRRESTORE_APPS_ADDR A:0x61e2505c
y.create.l HWIO_APPS_SMMU_CB6_FSRRESTORE_APPS_ADDR A:0x61e2605c
y.create.l HWIO_APPS_SMMU_CB7_FSRRESTORE_APPS_ADDR A:0x61e2705c
y.create.l HWIO_APPS_SMMU_CB8_FSRRESTORE_APPS_ADDR A:0x61e2805c
y.create.l HWIO_APPS_SMMU_CB9_FSRRESTORE_APPS_ADDR A:0x61e2905c
y.create.l HWIO_APPS_SMMU_CB10_FSRRESTORE_APPS_ADDR A:0x61e2a05c
y.create.l HWIO_APPS_SMMU_CB11_FSRRESTORE_APPS_ADDR A:0x61e2b05c
y.create.l HWIO_APPS_SMMU_CB12_FSRRESTORE_APPS_ADDR A:0x61e2c05c
y.create.l HWIO_APPS_SMMU_CB13_FSRRESTORE_APPS_ADDR A:0x61e2d05c
y.create.l HWIO_APPS_SMMU_CB14_FSRRESTORE_APPS_ADDR A:0x61e2e05c
y.create.l HWIO_APPS_SMMU_CB15_FSRRESTORE_APPS_ADDR A:0x61e2f05c
y.create.l HWIO_APPS_SMMU_CB16_FSRRESTORE_APPS_ADDR A:0x61e3005c
y.create.l HWIO_APPS_SMMU_CB17_FSRRESTORE_APPS_ADDR A:0x61e3105c
y.create.l HWIO_APPS_SMMU_CB18_FSRRESTORE_APPS_ADDR A:0x61e3205c
y.create.l HWIO_APPS_SMMU_CB19_FSRRESTORE_APPS_ADDR A:0x61e3305c
y.create.l HWIO_APPS_SMMU_CB20_FSRRESTORE_APPS_ADDR A:0x61e3405c
y.create.l HWIO_APPS_SMMU_CB21_FSRRESTORE_APPS_ADDR A:0x61e3505c
y.create.l HWIO_APPS_SMMU_CB22_FSRRESTORE_APPS_ADDR A:0x61e3605c
y.create.l HWIO_APPS_SMMU_CB23_FSRRESTORE_APPS_ADDR A:0x61e3705c
y.create.l HWIO_APPS_SMMU_CB24_FSRRESTORE_APPS_ADDR A:0x61e3805c
y.create.l HWIO_APPS_SMMU_CB25_FSRRESTORE_APPS_ADDR A:0x61e3905c
y.create.l HWIO_APPS_SMMU_CB26_FSRRESTORE_APPS_ADDR A:0x61e3a05c
y.create.l HWIO_APPS_SMMU_CB27_FSRRESTORE_APPS_ADDR A:0x61e3b05c
y.create.l HWIO_APPS_SMMU_CB28_FSRRESTORE_APPS_ADDR A:0x61e3c05c
y.create.l HWIO_APPS_SMMU_CB29_FSRRESTORE_APPS_ADDR A:0x61e3d05c
y.create.l HWIO_APPS_SMMU_CB30_FSRRESTORE_APPS_ADDR A:0x61e3e05c
y.create.l HWIO_APPS_SMMU_CB31_FSRRESTORE_APPS_ADDR A:0x61e3f05c
y.create.l HWIO_APPS_SMMU_CB0_FAR_LOW_APPS_ADDR A:0x61e20060
y.create.l HWIO_APPS_SMMU_CB1_FAR_LOW_APPS_ADDR A:0x61e21060
y.create.l HWIO_APPS_SMMU_CB2_FAR_LOW_APPS_ADDR A:0x61e22060
y.create.l HWIO_APPS_SMMU_CB3_FAR_LOW_APPS_ADDR A:0x61e23060
y.create.l HWIO_APPS_SMMU_CB4_FAR_LOW_APPS_ADDR A:0x61e24060
y.create.l HWIO_APPS_SMMU_CB5_FAR_LOW_APPS_ADDR A:0x61e25060
y.create.l HWIO_APPS_SMMU_CB6_FAR_LOW_APPS_ADDR A:0x61e26060
y.create.l HWIO_APPS_SMMU_CB7_FAR_LOW_APPS_ADDR A:0x61e27060
y.create.l HWIO_APPS_SMMU_CB8_FAR_LOW_APPS_ADDR A:0x61e28060
y.create.l HWIO_APPS_SMMU_CB9_FAR_LOW_APPS_ADDR A:0x61e29060
y.create.l HWIO_APPS_SMMU_CB10_FAR_LOW_APPS_ADDR A:0x61e2a060
y.create.l HWIO_APPS_SMMU_CB11_FAR_LOW_APPS_ADDR A:0x61e2b060
y.create.l HWIO_APPS_SMMU_CB12_FAR_LOW_APPS_ADDR A:0x61e2c060
y.create.l HWIO_APPS_SMMU_CB13_FAR_LOW_APPS_ADDR A:0x61e2d060
y.create.l HWIO_APPS_SMMU_CB14_FAR_LOW_APPS_ADDR A:0x61e2e060
y.create.l HWIO_APPS_SMMU_CB15_FAR_LOW_APPS_ADDR A:0x61e2f060
y.create.l HWIO_APPS_SMMU_CB16_FAR_LOW_APPS_ADDR A:0x61e30060
y.create.l HWIO_APPS_SMMU_CB17_FAR_LOW_APPS_ADDR A:0x61e31060
y.create.l HWIO_APPS_SMMU_CB18_FAR_LOW_APPS_ADDR A:0x61e32060
y.create.l HWIO_APPS_SMMU_CB19_FAR_LOW_APPS_ADDR A:0x61e33060
y.create.l HWIO_APPS_SMMU_CB20_FAR_LOW_APPS_ADDR A:0x61e34060
y.create.l HWIO_APPS_SMMU_CB21_FAR_LOW_APPS_ADDR A:0x61e35060
y.create.l HWIO_APPS_SMMU_CB22_FAR_LOW_APPS_ADDR A:0x61e36060
y.create.l HWIO_APPS_SMMU_CB23_FAR_LOW_APPS_ADDR A:0x61e37060
y.create.l HWIO_APPS_SMMU_CB24_FAR_LOW_APPS_ADDR A:0x61e38060
y.create.l HWIO_APPS_SMMU_CB25_FAR_LOW_APPS_ADDR A:0x61e39060
y.create.l HWIO_APPS_SMMU_CB26_FAR_LOW_APPS_ADDR A:0x61e3a060
y.create.l HWIO_APPS_SMMU_CB27_FAR_LOW_APPS_ADDR A:0x61e3b060
y.create.l HWIO_APPS_SMMU_CB28_FAR_LOW_APPS_ADDR A:0x61e3c060
y.create.l HWIO_APPS_SMMU_CB29_FAR_LOW_APPS_ADDR A:0x61e3d060
y.create.l HWIO_APPS_SMMU_CB30_FAR_LOW_APPS_ADDR A:0x61e3e060
y.create.l HWIO_APPS_SMMU_CB31_FAR_LOW_APPS_ADDR A:0x61e3f060
y.create.l HWIO_APPS_SMMU_CB0_FAR_HIGH_APPS_ADDR A:0x61e20064
y.create.l HWIO_APPS_SMMU_CB1_FAR_HIGH_APPS_ADDR A:0x61e21064
y.create.l HWIO_APPS_SMMU_CB2_FAR_HIGH_APPS_ADDR A:0x61e22064
y.create.l HWIO_APPS_SMMU_CB3_FAR_HIGH_APPS_ADDR A:0x61e23064
y.create.l HWIO_APPS_SMMU_CB4_FAR_HIGH_APPS_ADDR A:0x61e24064
y.create.l HWIO_APPS_SMMU_CB5_FAR_HIGH_APPS_ADDR A:0x61e25064
y.create.l HWIO_APPS_SMMU_CB6_FAR_HIGH_APPS_ADDR A:0x61e26064
y.create.l HWIO_APPS_SMMU_CB7_FAR_HIGH_APPS_ADDR A:0x61e27064
y.create.l HWIO_APPS_SMMU_CB8_FAR_HIGH_APPS_ADDR A:0x61e28064
y.create.l HWIO_APPS_SMMU_CB9_FAR_HIGH_APPS_ADDR A:0x61e29064
y.create.l HWIO_APPS_SMMU_CB10_FAR_HIGH_APPS_ADDR A:0x61e2a064
y.create.l HWIO_APPS_SMMU_CB11_FAR_HIGH_APPS_ADDR A:0x61e2b064
y.create.l HWIO_APPS_SMMU_CB12_FAR_HIGH_APPS_ADDR A:0x61e2c064
y.create.l HWIO_APPS_SMMU_CB13_FAR_HIGH_APPS_ADDR A:0x61e2d064
y.create.l HWIO_APPS_SMMU_CB14_FAR_HIGH_APPS_ADDR A:0x61e2e064
y.create.l HWIO_APPS_SMMU_CB15_FAR_HIGH_APPS_ADDR A:0x61e2f064
y.create.l HWIO_APPS_SMMU_CB16_FAR_HIGH_APPS_ADDR A:0x61e30064
y.create.l HWIO_APPS_SMMU_CB17_FAR_HIGH_APPS_ADDR A:0x61e31064
y.create.l HWIO_APPS_SMMU_CB18_FAR_HIGH_APPS_ADDR A:0x61e32064
y.create.l HWIO_APPS_SMMU_CB19_FAR_HIGH_APPS_ADDR A:0x61e33064
y.create.l HWIO_APPS_SMMU_CB20_FAR_HIGH_APPS_ADDR A:0x61e34064
y.create.l HWIO_APPS_SMMU_CB21_FAR_HIGH_APPS_ADDR A:0x61e35064
y.create.l HWIO_APPS_SMMU_CB22_FAR_HIGH_APPS_ADDR A:0x61e36064
y.create.l HWIO_APPS_SMMU_CB23_FAR_HIGH_APPS_ADDR A:0x61e37064
y.create.l HWIO_APPS_SMMU_CB24_FAR_HIGH_APPS_ADDR A:0x61e38064
y.create.l HWIO_APPS_SMMU_CB25_FAR_HIGH_APPS_ADDR A:0x61e39064
y.create.l HWIO_APPS_SMMU_CB26_FAR_HIGH_APPS_ADDR A:0x61e3a064
y.create.l HWIO_APPS_SMMU_CB27_FAR_HIGH_APPS_ADDR A:0x61e3b064
y.create.l HWIO_APPS_SMMU_CB28_FAR_HIGH_APPS_ADDR A:0x61e3c064
y.create.l HWIO_APPS_SMMU_CB29_FAR_HIGH_APPS_ADDR A:0x61e3d064
y.create.l HWIO_APPS_SMMU_CB30_FAR_HIGH_APPS_ADDR A:0x61e3e064
y.create.l HWIO_APPS_SMMU_CB31_FAR_HIGH_APPS_ADDR A:0x61e3f064
y.create.l HWIO_APPS_SMMU_CB0_FSYNR0_APPS_ADDR A:0x61e20068
y.create.l HWIO_APPS_SMMU_CB1_FSYNR0_APPS_ADDR A:0x61e21068
y.create.l HWIO_APPS_SMMU_CB2_FSYNR0_APPS_ADDR A:0x61e22068
y.create.l HWIO_APPS_SMMU_CB3_FSYNR0_APPS_ADDR A:0x61e23068
y.create.l HWIO_APPS_SMMU_CB4_FSYNR0_APPS_ADDR A:0x61e24068
y.create.l HWIO_APPS_SMMU_CB5_FSYNR0_APPS_ADDR A:0x61e25068
y.create.l HWIO_APPS_SMMU_CB6_FSYNR0_APPS_ADDR A:0x61e26068
y.create.l HWIO_APPS_SMMU_CB7_FSYNR0_APPS_ADDR A:0x61e27068
y.create.l HWIO_APPS_SMMU_CB8_FSYNR0_APPS_ADDR A:0x61e28068
y.create.l HWIO_APPS_SMMU_CB9_FSYNR0_APPS_ADDR A:0x61e29068
y.create.l HWIO_APPS_SMMU_CB10_FSYNR0_APPS_ADDR A:0x61e2a068
y.create.l HWIO_APPS_SMMU_CB11_FSYNR0_APPS_ADDR A:0x61e2b068
y.create.l HWIO_APPS_SMMU_CB12_FSYNR0_APPS_ADDR A:0x61e2c068
y.create.l HWIO_APPS_SMMU_CB13_FSYNR0_APPS_ADDR A:0x61e2d068
y.create.l HWIO_APPS_SMMU_CB14_FSYNR0_APPS_ADDR A:0x61e2e068
y.create.l HWIO_APPS_SMMU_CB15_FSYNR0_APPS_ADDR A:0x61e2f068
y.create.l HWIO_APPS_SMMU_CB16_FSYNR0_APPS_ADDR A:0x61e30068
y.create.l HWIO_APPS_SMMU_CB17_FSYNR0_APPS_ADDR A:0x61e31068
y.create.l HWIO_APPS_SMMU_CB18_FSYNR0_APPS_ADDR A:0x61e32068
y.create.l HWIO_APPS_SMMU_CB19_FSYNR0_APPS_ADDR A:0x61e33068
y.create.l HWIO_APPS_SMMU_CB20_FSYNR0_APPS_ADDR A:0x61e34068
y.create.l HWIO_APPS_SMMU_CB21_FSYNR0_APPS_ADDR A:0x61e35068
y.create.l HWIO_APPS_SMMU_CB22_FSYNR0_APPS_ADDR A:0x61e36068
y.create.l HWIO_APPS_SMMU_CB23_FSYNR0_APPS_ADDR A:0x61e37068
y.create.l HWIO_APPS_SMMU_CB24_FSYNR0_APPS_ADDR A:0x61e38068
y.create.l HWIO_APPS_SMMU_CB25_FSYNR0_APPS_ADDR A:0x61e39068
y.create.l HWIO_APPS_SMMU_CB26_FSYNR0_APPS_ADDR A:0x61e3a068
y.create.l HWIO_APPS_SMMU_CB27_FSYNR0_APPS_ADDR A:0x61e3b068
y.create.l HWIO_APPS_SMMU_CB28_FSYNR0_APPS_ADDR A:0x61e3c068
y.create.l HWIO_APPS_SMMU_CB29_FSYNR0_APPS_ADDR A:0x61e3d068
y.create.l HWIO_APPS_SMMU_CB30_FSYNR0_APPS_ADDR A:0x61e3e068
y.create.l HWIO_APPS_SMMU_CB31_FSYNR0_APPS_ADDR A:0x61e3f068
y.create.l HWIO_APPS_SMMU_CB0_IPAFAR_LOW_APPS_ADDR A:0x61e20070
y.create.l HWIO_APPS_SMMU_CB1_IPAFAR_LOW_APPS_ADDR A:0x61e21070
y.create.l HWIO_APPS_SMMU_CB2_IPAFAR_LOW_APPS_ADDR A:0x61e22070
y.create.l HWIO_APPS_SMMU_CB3_IPAFAR_LOW_APPS_ADDR A:0x61e23070
y.create.l HWIO_APPS_SMMU_CB4_IPAFAR_LOW_APPS_ADDR A:0x61e24070
y.create.l HWIO_APPS_SMMU_CB5_IPAFAR_LOW_APPS_ADDR A:0x61e25070
y.create.l HWIO_APPS_SMMU_CB6_IPAFAR_LOW_APPS_ADDR A:0x61e26070
y.create.l HWIO_APPS_SMMU_CB7_IPAFAR_LOW_APPS_ADDR A:0x61e27070
y.create.l HWIO_APPS_SMMU_CB8_IPAFAR_LOW_APPS_ADDR A:0x61e28070
y.create.l HWIO_APPS_SMMU_CB9_IPAFAR_LOW_APPS_ADDR A:0x61e29070
y.create.l HWIO_APPS_SMMU_CB10_IPAFAR_LOW_APPS_ADDR A:0x61e2a070
y.create.l HWIO_APPS_SMMU_CB11_IPAFAR_LOW_APPS_ADDR A:0x61e2b070
y.create.l HWIO_APPS_SMMU_CB12_IPAFAR_LOW_APPS_ADDR A:0x61e2c070
y.create.l HWIO_APPS_SMMU_CB13_IPAFAR_LOW_APPS_ADDR A:0x61e2d070
y.create.l HWIO_APPS_SMMU_CB14_IPAFAR_LOW_APPS_ADDR A:0x61e2e070
y.create.l HWIO_APPS_SMMU_CB15_IPAFAR_LOW_APPS_ADDR A:0x61e2f070
y.create.l HWIO_APPS_SMMU_CB16_IPAFAR_LOW_APPS_ADDR A:0x61e30070
y.create.l HWIO_APPS_SMMU_CB17_IPAFAR_LOW_APPS_ADDR A:0x61e31070
y.create.l HWIO_APPS_SMMU_CB18_IPAFAR_LOW_APPS_ADDR A:0x61e32070
y.create.l HWIO_APPS_SMMU_CB19_IPAFAR_LOW_APPS_ADDR A:0x61e33070
y.create.l HWIO_APPS_SMMU_CB20_IPAFAR_LOW_APPS_ADDR A:0x61e34070
y.create.l HWIO_APPS_SMMU_CB21_IPAFAR_LOW_APPS_ADDR A:0x61e35070
y.create.l HWIO_APPS_SMMU_CB22_IPAFAR_LOW_APPS_ADDR A:0x61e36070
y.create.l HWIO_APPS_SMMU_CB23_IPAFAR_LOW_APPS_ADDR A:0x61e37070
y.create.l HWIO_APPS_SMMU_CB24_IPAFAR_LOW_APPS_ADDR A:0x61e38070
y.create.l HWIO_APPS_SMMU_CB25_IPAFAR_LOW_APPS_ADDR A:0x61e39070
y.create.l HWIO_APPS_SMMU_CB26_IPAFAR_LOW_APPS_ADDR A:0x61e3a070
y.create.l HWIO_APPS_SMMU_CB27_IPAFAR_LOW_APPS_ADDR A:0x61e3b070
y.create.l HWIO_APPS_SMMU_CB28_IPAFAR_LOW_APPS_ADDR A:0x61e3c070
y.create.l HWIO_APPS_SMMU_CB29_IPAFAR_LOW_APPS_ADDR A:0x61e3d070
y.create.l HWIO_APPS_SMMU_CB30_IPAFAR_LOW_APPS_ADDR A:0x61e3e070
y.create.l HWIO_APPS_SMMU_CB31_IPAFAR_LOW_APPS_ADDR A:0x61e3f070
y.create.l HWIO_APPS_SMMU_CB0_IPAFAR_HIGH_APPS_ADDR A:0x61e20074
y.create.l HWIO_APPS_SMMU_CB1_IPAFAR_HIGH_APPS_ADDR A:0x61e21074
y.create.l HWIO_APPS_SMMU_CB2_IPAFAR_HIGH_APPS_ADDR A:0x61e22074
y.create.l HWIO_APPS_SMMU_CB3_IPAFAR_HIGH_APPS_ADDR A:0x61e23074
y.create.l HWIO_APPS_SMMU_CB4_IPAFAR_HIGH_APPS_ADDR A:0x61e24074
y.create.l HWIO_APPS_SMMU_CB5_IPAFAR_HIGH_APPS_ADDR A:0x61e25074
y.create.l HWIO_APPS_SMMU_CB6_IPAFAR_HIGH_APPS_ADDR A:0x61e26074
y.create.l HWIO_APPS_SMMU_CB7_IPAFAR_HIGH_APPS_ADDR A:0x61e27074
y.create.l HWIO_APPS_SMMU_CB8_IPAFAR_HIGH_APPS_ADDR A:0x61e28074
y.create.l HWIO_APPS_SMMU_CB9_IPAFAR_HIGH_APPS_ADDR A:0x61e29074
y.create.l HWIO_APPS_SMMU_CB10_IPAFAR_HIGH_APPS_ADDR A:0x61e2a074
y.create.l HWIO_APPS_SMMU_CB11_IPAFAR_HIGH_APPS_ADDR A:0x61e2b074
y.create.l HWIO_APPS_SMMU_CB12_IPAFAR_HIGH_APPS_ADDR A:0x61e2c074
y.create.l HWIO_APPS_SMMU_CB13_IPAFAR_HIGH_APPS_ADDR A:0x61e2d074
y.create.l HWIO_APPS_SMMU_CB14_IPAFAR_HIGH_APPS_ADDR A:0x61e2e074
y.create.l HWIO_APPS_SMMU_CB15_IPAFAR_HIGH_APPS_ADDR A:0x61e2f074
y.create.l HWIO_APPS_SMMU_CB16_IPAFAR_HIGH_APPS_ADDR A:0x61e30074
y.create.l HWIO_APPS_SMMU_CB17_IPAFAR_HIGH_APPS_ADDR A:0x61e31074
y.create.l HWIO_APPS_SMMU_CB18_IPAFAR_HIGH_APPS_ADDR A:0x61e32074
y.create.l HWIO_APPS_SMMU_CB19_IPAFAR_HIGH_APPS_ADDR A:0x61e33074
y.create.l HWIO_APPS_SMMU_CB20_IPAFAR_HIGH_APPS_ADDR A:0x61e34074
y.create.l HWIO_APPS_SMMU_CB21_IPAFAR_HIGH_APPS_ADDR A:0x61e35074
y.create.l HWIO_APPS_SMMU_CB22_IPAFAR_HIGH_APPS_ADDR A:0x61e36074
y.create.l HWIO_APPS_SMMU_CB23_IPAFAR_HIGH_APPS_ADDR A:0x61e37074
y.create.l HWIO_APPS_SMMU_CB24_IPAFAR_HIGH_APPS_ADDR A:0x61e38074
y.create.l HWIO_APPS_SMMU_CB25_IPAFAR_HIGH_APPS_ADDR A:0x61e39074
y.create.l HWIO_APPS_SMMU_CB26_IPAFAR_HIGH_APPS_ADDR A:0x61e3a074
y.create.l HWIO_APPS_SMMU_CB27_IPAFAR_HIGH_APPS_ADDR A:0x61e3b074
y.create.l HWIO_APPS_SMMU_CB28_IPAFAR_HIGH_APPS_ADDR A:0x61e3c074
y.create.l HWIO_APPS_SMMU_CB29_IPAFAR_HIGH_APPS_ADDR A:0x61e3d074
y.create.l HWIO_APPS_SMMU_CB30_IPAFAR_HIGH_APPS_ADDR A:0x61e3e074
y.create.l HWIO_APPS_SMMU_CB31_IPAFAR_HIGH_APPS_ADDR A:0x61e3f074
y.create.l HWIO_APPS_SMMU_CB0_TLBIVA_LOW_APPS_ADDR A:0x61e20600
y.create.l HWIO_APPS_SMMU_CB1_TLBIVA_LOW_APPS_ADDR A:0x61e21600
y.create.l HWIO_APPS_SMMU_CB2_TLBIVA_LOW_APPS_ADDR A:0x61e22600
y.create.l HWIO_APPS_SMMU_CB3_TLBIVA_LOW_APPS_ADDR A:0x61e23600
y.create.l HWIO_APPS_SMMU_CB4_TLBIVA_LOW_APPS_ADDR A:0x61e24600
y.create.l HWIO_APPS_SMMU_CB5_TLBIVA_LOW_APPS_ADDR A:0x61e25600
y.create.l HWIO_APPS_SMMU_CB6_TLBIVA_LOW_APPS_ADDR A:0x61e26600
y.create.l HWIO_APPS_SMMU_CB7_TLBIVA_LOW_APPS_ADDR A:0x61e27600
y.create.l HWIO_APPS_SMMU_CB8_TLBIVA_LOW_APPS_ADDR A:0x61e28600
y.create.l HWIO_APPS_SMMU_CB9_TLBIVA_LOW_APPS_ADDR A:0x61e29600
y.create.l HWIO_APPS_SMMU_CB10_TLBIVA_LOW_APPS_ADDR A:0x61e2a600
y.create.l HWIO_APPS_SMMU_CB11_TLBIVA_LOW_APPS_ADDR A:0x61e2b600
y.create.l HWIO_APPS_SMMU_CB12_TLBIVA_LOW_APPS_ADDR A:0x61e2c600
y.create.l HWIO_APPS_SMMU_CB13_TLBIVA_LOW_APPS_ADDR A:0x61e2d600
y.create.l HWIO_APPS_SMMU_CB14_TLBIVA_LOW_APPS_ADDR A:0x61e2e600
y.create.l HWIO_APPS_SMMU_CB15_TLBIVA_LOW_APPS_ADDR A:0x61e2f600
y.create.l HWIO_APPS_SMMU_CB16_TLBIVA_LOW_APPS_ADDR A:0x61e30600
y.create.l HWIO_APPS_SMMU_CB17_TLBIVA_LOW_APPS_ADDR A:0x61e31600
y.create.l HWIO_APPS_SMMU_CB18_TLBIVA_LOW_APPS_ADDR A:0x61e32600
y.create.l HWIO_APPS_SMMU_CB19_TLBIVA_LOW_APPS_ADDR A:0x61e33600
y.create.l HWIO_APPS_SMMU_CB20_TLBIVA_LOW_APPS_ADDR A:0x61e34600
y.create.l HWIO_APPS_SMMU_CB21_TLBIVA_LOW_APPS_ADDR A:0x61e35600
y.create.l HWIO_APPS_SMMU_CB22_TLBIVA_LOW_APPS_ADDR A:0x61e36600
y.create.l HWIO_APPS_SMMU_CB23_TLBIVA_LOW_APPS_ADDR A:0x61e37600
y.create.l HWIO_APPS_SMMU_CB24_TLBIVA_LOW_APPS_ADDR A:0x61e38600
y.create.l HWIO_APPS_SMMU_CB25_TLBIVA_LOW_APPS_ADDR A:0x61e39600
y.create.l HWIO_APPS_SMMU_CB26_TLBIVA_LOW_APPS_ADDR A:0x61e3a600
y.create.l HWIO_APPS_SMMU_CB27_TLBIVA_LOW_APPS_ADDR A:0x61e3b600
y.create.l HWIO_APPS_SMMU_CB28_TLBIVA_LOW_APPS_ADDR A:0x61e3c600
y.create.l HWIO_APPS_SMMU_CB29_TLBIVA_LOW_APPS_ADDR A:0x61e3d600
y.create.l HWIO_APPS_SMMU_CB30_TLBIVA_LOW_APPS_ADDR A:0x61e3e600
y.create.l HWIO_APPS_SMMU_CB31_TLBIVA_LOW_APPS_ADDR A:0x61e3f600
y.create.l HWIO_APPS_SMMU_CB0_TLBIVA_HIGH_APPS_ADDR A:0x61e20604
y.create.l HWIO_APPS_SMMU_CB1_TLBIVA_HIGH_APPS_ADDR A:0x61e21604
y.create.l HWIO_APPS_SMMU_CB2_TLBIVA_HIGH_APPS_ADDR A:0x61e22604
y.create.l HWIO_APPS_SMMU_CB3_TLBIVA_HIGH_APPS_ADDR A:0x61e23604
y.create.l HWIO_APPS_SMMU_CB4_TLBIVA_HIGH_APPS_ADDR A:0x61e24604
y.create.l HWIO_APPS_SMMU_CB5_TLBIVA_HIGH_APPS_ADDR A:0x61e25604
y.create.l HWIO_APPS_SMMU_CB6_TLBIVA_HIGH_APPS_ADDR A:0x61e26604
y.create.l HWIO_APPS_SMMU_CB7_TLBIVA_HIGH_APPS_ADDR A:0x61e27604
y.create.l HWIO_APPS_SMMU_CB8_TLBIVA_HIGH_APPS_ADDR A:0x61e28604
y.create.l HWIO_APPS_SMMU_CB9_TLBIVA_HIGH_APPS_ADDR A:0x61e29604
y.create.l HWIO_APPS_SMMU_CB10_TLBIVA_HIGH_APPS_ADDR A:0x61e2a604
y.create.l HWIO_APPS_SMMU_CB11_TLBIVA_HIGH_APPS_ADDR A:0x61e2b604
y.create.l HWIO_APPS_SMMU_CB12_TLBIVA_HIGH_APPS_ADDR A:0x61e2c604
y.create.l HWIO_APPS_SMMU_CB13_TLBIVA_HIGH_APPS_ADDR A:0x61e2d604
y.create.l HWIO_APPS_SMMU_CB14_TLBIVA_HIGH_APPS_ADDR A:0x61e2e604
y.create.l HWIO_APPS_SMMU_CB15_TLBIVA_HIGH_APPS_ADDR A:0x61e2f604
y.create.l HWIO_APPS_SMMU_CB16_TLBIVA_HIGH_APPS_ADDR A:0x61e30604
y.create.l HWIO_APPS_SMMU_CB17_TLBIVA_HIGH_APPS_ADDR A:0x61e31604
y.create.l HWIO_APPS_SMMU_CB18_TLBIVA_HIGH_APPS_ADDR A:0x61e32604
y.create.l HWIO_APPS_SMMU_CB19_TLBIVA_HIGH_APPS_ADDR A:0x61e33604
y.create.l HWIO_APPS_SMMU_CB20_TLBIVA_HIGH_APPS_ADDR A:0x61e34604
y.create.l HWIO_APPS_SMMU_CB21_TLBIVA_HIGH_APPS_ADDR A:0x61e35604
y.create.l HWIO_APPS_SMMU_CB22_TLBIVA_HIGH_APPS_ADDR A:0x61e36604
y.create.l HWIO_APPS_SMMU_CB23_TLBIVA_HIGH_APPS_ADDR A:0x61e37604
y.create.l HWIO_APPS_SMMU_CB24_TLBIVA_HIGH_APPS_ADDR A:0x61e38604
y.create.l HWIO_APPS_SMMU_CB25_TLBIVA_HIGH_APPS_ADDR A:0x61e39604
y.create.l HWIO_APPS_SMMU_CB26_TLBIVA_HIGH_APPS_ADDR A:0x61e3a604
y.create.l HWIO_APPS_SMMU_CB27_TLBIVA_HIGH_APPS_ADDR A:0x61e3b604
y.create.l HWIO_APPS_SMMU_CB28_TLBIVA_HIGH_APPS_ADDR A:0x61e3c604
y.create.l HWIO_APPS_SMMU_CB29_TLBIVA_HIGH_APPS_ADDR A:0x61e3d604
y.create.l HWIO_APPS_SMMU_CB30_TLBIVA_HIGH_APPS_ADDR A:0x61e3e604
y.create.l HWIO_APPS_SMMU_CB31_TLBIVA_HIGH_APPS_ADDR A:0x61e3f604
y.create.l HWIO_APPS_SMMU_CB0_TLBIVAA_LOW_APPS_ADDR A:0x61e20608
y.create.l HWIO_APPS_SMMU_CB1_TLBIVAA_LOW_APPS_ADDR A:0x61e21608
y.create.l HWIO_APPS_SMMU_CB2_TLBIVAA_LOW_APPS_ADDR A:0x61e22608
y.create.l HWIO_APPS_SMMU_CB3_TLBIVAA_LOW_APPS_ADDR A:0x61e23608
y.create.l HWIO_APPS_SMMU_CB4_TLBIVAA_LOW_APPS_ADDR A:0x61e24608
y.create.l HWIO_APPS_SMMU_CB5_TLBIVAA_LOW_APPS_ADDR A:0x61e25608
y.create.l HWIO_APPS_SMMU_CB6_TLBIVAA_LOW_APPS_ADDR A:0x61e26608
y.create.l HWIO_APPS_SMMU_CB7_TLBIVAA_LOW_APPS_ADDR A:0x61e27608
y.create.l HWIO_APPS_SMMU_CB8_TLBIVAA_LOW_APPS_ADDR A:0x61e28608
y.create.l HWIO_APPS_SMMU_CB9_TLBIVAA_LOW_APPS_ADDR A:0x61e29608
y.create.l HWIO_APPS_SMMU_CB10_TLBIVAA_LOW_APPS_ADDR A:0x61e2a608
y.create.l HWIO_APPS_SMMU_CB11_TLBIVAA_LOW_APPS_ADDR A:0x61e2b608
y.create.l HWIO_APPS_SMMU_CB12_TLBIVAA_LOW_APPS_ADDR A:0x61e2c608
y.create.l HWIO_APPS_SMMU_CB13_TLBIVAA_LOW_APPS_ADDR A:0x61e2d608
y.create.l HWIO_APPS_SMMU_CB14_TLBIVAA_LOW_APPS_ADDR A:0x61e2e608
y.create.l HWIO_APPS_SMMU_CB15_TLBIVAA_LOW_APPS_ADDR A:0x61e2f608
y.create.l HWIO_APPS_SMMU_CB16_TLBIVAA_LOW_APPS_ADDR A:0x61e30608
y.create.l HWIO_APPS_SMMU_CB17_TLBIVAA_LOW_APPS_ADDR A:0x61e31608
y.create.l HWIO_APPS_SMMU_CB18_TLBIVAA_LOW_APPS_ADDR A:0x61e32608
y.create.l HWIO_APPS_SMMU_CB19_TLBIVAA_LOW_APPS_ADDR A:0x61e33608
y.create.l HWIO_APPS_SMMU_CB20_TLBIVAA_LOW_APPS_ADDR A:0x61e34608
y.create.l HWIO_APPS_SMMU_CB21_TLBIVAA_LOW_APPS_ADDR A:0x61e35608
y.create.l HWIO_APPS_SMMU_CB22_TLBIVAA_LOW_APPS_ADDR A:0x61e36608
y.create.l HWIO_APPS_SMMU_CB23_TLBIVAA_LOW_APPS_ADDR A:0x61e37608
y.create.l HWIO_APPS_SMMU_CB24_TLBIVAA_LOW_APPS_ADDR A:0x61e38608
y.create.l HWIO_APPS_SMMU_CB25_TLBIVAA_LOW_APPS_ADDR A:0x61e39608
y.create.l HWIO_APPS_SMMU_CB26_TLBIVAA_LOW_APPS_ADDR A:0x61e3a608
y.create.l HWIO_APPS_SMMU_CB27_TLBIVAA_LOW_APPS_ADDR A:0x61e3b608
y.create.l HWIO_APPS_SMMU_CB28_TLBIVAA_LOW_APPS_ADDR A:0x61e3c608
y.create.l HWIO_APPS_SMMU_CB29_TLBIVAA_LOW_APPS_ADDR A:0x61e3d608
y.create.l HWIO_APPS_SMMU_CB30_TLBIVAA_LOW_APPS_ADDR A:0x61e3e608
y.create.l HWIO_APPS_SMMU_CB31_TLBIVAA_LOW_APPS_ADDR A:0x61e3f608
y.create.l HWIO_APPS_SMMU_CB0_TLBIVAA_HIGH_APPS_ADDR A:0x61e2060c
y.create.l HWIO_APPS_SMMU_CB1_TLBIVAA_HIGH_APPS_ADDR A:0x61e2160c
y.create.l HWIO_APPS_SMMU_CB2_TLBIVAA_HIGH_APPS_ADDR A:0x61e2260c
y.create.l HWIO_APPS_SMMU_CB3_TLBIVAA_HIGH_APPS_ADDR A:0x61e2360c
y.create.l HWIO_APPS_SMMU_CB4_TLBIVAA_HIGH_APPS_ADDR A:0x61e2460c
y.create.l HWIO_APPS_SMMU_CB5_TLBIVAA_HIGH_APPS_ADDR A:0x61e2560c
y.create.l HWIO_APPS_SMMU_CB6_TLBIVAA_HIGH_APPS_ADDR A:0x61e2660c
y.create.l HWIO_APPS_SMMU_CB7_TLBIVAA_HIGH_APPS_ADDR A:0x61e2760c
y.create.l HWIO_APPS_SMMU_CB8_TLBIVAA_HIGH_APPS_ADDR A:0x61e2860c
y.create.l HWIO_APPS_SMMU_CB9_TLBIVAA_HIGH_APPS_ADDR A:0x61e2960c
y.create.l HWIO_APPS_SMMU_CB10_TLBIVAA_HIGH_APPS_ADDR A:0x61e2a60c
y.create.l HWIO_APPS_SMMU_CB11_TLBIVAA_HIGH_APPS_ADDR A:0x61e2b60c
y.create.l HWIO_APPS_SMMU_CB12_TLBIVAA_HIGH_APPS_ADDR A:0x61e2c60c
y.create.l HWIO_APPS_SMMU_CB13_TLBIVAA_HIGH_APPS_ADDR A:0x61e2d60c
y.create.l HWIO_APPS_SMMU_CB14_TLBIVAA_HIGH_APPS_ADDR A:0x61e2e60c
y.create.l HWIO_APPS_SMMU_CB15_TLBIVAA_HIGH_APPS_ADDR A:0x61e2f60c
y.create.l HWIO_APPS_SMMU_CB16_TLBIVAA_HIGH_APPS_ADDR A:0x61e3060c
y.create.l HWIO_APPS_SMMU_CB17_TLBIVAA_HIGH_APPS_ADDR A:0x61e3160c
y.create.l HWIO_APPS_SMMU_CB18_TLBIVAA_HIGH_APPS_ADDR A:0x61e3260c
y.create.l HWIO_APPS_SMMU_CB19_TLBIVAA_HIGH_APPS_ADDR A:0x61e3360c
y.create.l HWIO_APPS_SMMU_CB20_TLBIVAA_HIGH_APPS_ADDR A:0x61e3460c
y.create.l HWIO_APPS_SMMU_CB21_TLBIVAA_HIGH_APPS_ADDR A:0x61e3560c
y.create.l HWIO_APPS_SMMU_CB22_TLBIVAA_HIGH_APPS_ADDR A:0x61e3660c
y.create.l HWIO_APPS_SMMU_CB23_TLBIVAA_HIGH_APPS_ADDR A:0x61e3760c
y.create.l HWIO_APPS_SMMU_CB24_TLBIVAA_HIGH_APPS_ADDR A:0x61e3860c
y.create.l HWIO_APPS_SMMU_CB25_TLBIVAA_HIGH_APPS_ADDR A:0x61e3960c
y.create.l HWIO_APPS_SMMU_CB26_TLBIVAA_HIGH_APPS_ADDR A:0x61e3a60c
y.create.l HWIO_APPS_SMMU_CB27_TLBIVAA_HIGH_APPS_ADDR A:0x61e3b60c
y.create.l HWIO_APPS_SMMU_CB28_TLBIVAA_HIGH_APPS_ADDR A:0x61e3c60c
y.create.l HWIO_APPS_SMMU_CB29_TLBIVAA_HIGH_APPS_ADDR A:0x61e3d60c
y.create.l HWIO_APPS_SMMU_CB30_TLBIVAA_HIGH_APPS_ADDR A:0x61e3e60c
y.create.l HWIO_APPS_SMMU_CB31_TLBIVAA_HIGH_APPS_ADDR A:0x61e3f60c
y.create.l HWIO_APPS_SMMU_CB0_TLBIASID_APPS_ADDR A:0x61e20610
y.create.l HWIO_APPS_SMMU_CB1_TLBIASID_APPS_ADDR A:0x61e21610
y.create.l HWIO_APPS_SMMU_CB2_TLBIASID_APPS_ADDR A:0x61e22610
y.create.l HWIO_APPS_SMMU_CB3_TLBIASID_APPS_ADDR A:0x61e23610
y.create.l HWIO_APPS_SMMU_CB4_TLBIASID_APPS_ADDR A:0x61e24610
y.create.l HWIO_APPS_SMMU_CB5_TLBIASID_APPS_ADDR A:0x61e25610
y.create.l HWIO_APPS_SMMU_CB6_TLBIASID_APPS_ADDR A:0x61e26610
y.create.l HWIO_APPS_SMMU_CB7_TLBIASID_APPS_ADDR A:0x61e27610
y.create.l HWIO_APPS_SMMU_CB8_TLBIASID_APPS_ADDR A:0x61e28610
y.create.l HWIO_APPS_SMMU_CB9_TLBIASID_APPS_ADDR A:0x61e29610
y.create.l HWIO_APPS_SMMU_CB10_TLBIASID_APPS_ADDR A:0x61e2a610
y.create.l HWIO_APPS_SMMU_CB11_TLBIASID_APPS_ADDR A:0x61e2b610
y.create.l HWIO_APPS_SMMU_CB12_TLBIASID_APPS_ADDR A:0x61e2c610
y.create.l HWIO_APPS_SMMU_CB13_TLBIASID_APPS_ADDR A:0x61e2d610
y.create.l HWIO_APPS_SMMU_CB14_TLBIASID_APPS_ADDR A:0x61e2e610
y.create.l HWIO_APPS_SMMU_CB15_TLBIASID_APPS_ADDR A:0x61e2f610
y.create.l HWIO_APPS_SMMU_CB16_TLBIASID_APPS_ADDR A:0x61e30610
y.create.l HWIO_APPS_SMMU_CB17_TLBIASID_APPS_ADDR A:0x61e31610
y.create.l HWIO_APPS_SMMU_CB18_TLBIASID_APPS_ADDR A:0x61e32610
y.create.l HWIO_APPS_SMMU_CB19_TLBIASID_APPS_ADDR A:0x61e33610
y.create.l HWIO_APPS_SMMU_CB20_TLBIASID_APPS_ADDR A:0x61e34610
y.create.l HWIO_APPS_SMMU_CB21_TLBIASID_APPS_ADDR A:0x61e35610
y.create.l HWIO_APPS_SMMU_CB22_TLBIASID_APPS_ADDR A:0x61e36610
y.create.l HWIO_APPS_SMMU_CB23_TLBIASID_APPS_ADDR A:0x61e37610
y.create.l HWIO_APPS_SMMU_CB24_TLBIASID_APPS_ADDR A:0x61e38610
y.create.l HWIO_APPS_SMMU_CB25_TLBIASID_APPS_ADDR A:0x61e39610
y.create.l HWIO_APPS_SMMU_CB26_TLBIASID_APPS_ADDR A:0x61e3a610
y.create.l HWIO_APPS_SMMU_CB27_TLBIASID_APPS_ADDR A:0x61e3b610
y.create.l HWIO_APPS_SMMU_CB28_TLBIASID_APPS_ADDR A:0x61e3c610
y.create.l HWIO_APPS_SMMU_CB29_TLBIASID_APPS_ADDR A:0x61e3d610
y.create.l HWIO_APPS_SMMU_CB30_TLBIASID_APPS_ADDR A:0x61e3e610
y.create.l HWIO_APPS_SMMU_CB31_TLBIASID_APPS_ADDR A:0x61e3f610
y.create.l HWIO_APPS_SMMU_CB0_TLBIALL_APPS_ADDR A:0x61e20618
y.create.l HWIO_APPS_SMMU_CB1_TLBIALL_APPS_ADDR A:0x61e21618
y.create.l HWIO_APPS_SMMU_CB2_TLBIALL_APPS_ADDR A:0x61e22618
y.create.l HWIO_APPS_SMMU_CB3_TLBIALL_APPS_ADDR A:0x61e23618
y.create.l HWIO_APPS_SMMU_CB4_TLBIALL_APPS_ADDR A:0x61e24618
y.create.l HWIO_APPS_SMMU_CB5_TLBIALL_APPS_ADDR A:0x61e25618
y.create.l HWIO_APPS_SMMU_CB6_TLBIALL_APPS_ADDR A:0x61e26618
y.create.l HWIO_APPS_SMMU_CB7_TLBIALL_APPS_ADDR A:0x61e27618
y.create.l HWIO_APPS_SMMU_CB8_TLBIALL_APPS_ADDR A:0x61e28618
y.create.l HWIO_APPS_SMMU_CB9_TLBIALL_APPS_ADDR A:0x61e29618
y.create.l HWIO_APPS_SMMU_CB10_TLBIALL_APPS_ADDR A:0x61e2a618
y.create.l HWIO_APPS_SMMU_CB11_TLBIALL_APPS_ADDR A:0x61e2b618
y.create.l HWIO_APPS_SMMU_CB12_TLBIALL_APPS_ADDR A:0x61e2c618
y.create.l HWIO_APPS_SMMU_CB13_TLBIALL_APPS_ADDR A:0x61e2d618
y.create.l HWIO_APPS_SMMU_CB14_TLBIALL_APPS_ADDR A:0x61e2e618
y.create.l HWIO_APPS_SMMU_CB15_TLBIALL_APPS_ADDR A:0x61e2f618
y.create.l HWIO_APPS_SMMU_CB16_TLBIALL_APPS_ADDR A:0x61e30618
y.create.l HWIO_APPS_SMMU_CB17_TLBIALL_APPS_ADDR A:0x61e31618
y.create.l HWIO_APPS_SMMU_CB18_TLBIALL_APPS_ADDR A:0x61e32618
y.create.l HWIO_APPS_SMMU_CB19_TLBIALL_APPS_ADDR A:0x61e33618
y.create.l HWIO_APPS_SMMU_CB20_TLBIALL_APPS_ADDR A:0x61e34618
y.create.l HWIO_APPS_SMMU_CB21_TLBIALL_APPS_ADDR A:0x61e35618
y.create.l HWIO_APPS_SMMU_CB22_TLBIALL_APPS_ADDR A:0x61e36618
y.create.l HWIO_APPS_SMMU_CB23_TLBIALL_APPS_ADDR A:0x61e37618
y.create.l HWIO_APPS_SMMU_CB24_TLBIALL_APPS_ADDR A:0x61e38618
y.create.l HWIO_APPS_SMMU_CB25_TLBIALL_APPS_ADDR A:0x61e39618
y.create.l HWIO_APPS_SMMU_CB26_TLBIALL_APPS_ADDR A:0x61e3a618
y.create.l HWIO_APPS_SMMU_CB27_TLBIALL_APPS_ADDR A:0x61e3b618
y.create.l HWIO_APPS_SMMU_CB28_TLBIALL_APPS_ADDR A:0x61e3c618
y.create.l HWIO_APPS_SMMU_CB29_TLBIALL_APPS_ADDR A:0x61e3d618
y.create.l HWIO_APPS_SMMU_CB30_TLBIALL_APPS_ADDR A:0x61e3e618
y.create.l HWIO_APPS_SMMU_CB31_TLBIALL_APPS_ADDR A:0x61e3f618
y.create.l HWIO_APPS_SMMU_CB0_TLBIVAL_LOW_APPS_ADDR A:0x61e20620
y.create.l HWIO_APPS_SMMU_CB1_TLBIVAL_LOW_APPS_ADDR A:0x61e21620
y.create.l HWIO_APPS_SMMU_CB2_TLBIVAL_LOW_APPS_ADDR A:0x61e22620
y.create.l HWIO_APPS_SMMU_CB3_TLBIVAL_LOW_APPS_ADDR A:0x61e23620
y.create.l HWIO_APPS_SMMU_CB4_TLBIVAL_LOW_APPS_ADDR A:0x61e24620
y.create.l HWIO_APPS_SMMU_CB5_TLBIVAL_LOW_APPS_ADDR A:0x61e25620
y.create.l HWIO_APPS_SMMU_CB6_TLBIVAL_LOW_APPS_ADDR A:0x61e26620
y.create.l HWIO_APPS_SMMU_CB7_TLBIVAL_LOW_APPS_ADDR A:0x61e27620
y.create.l HWIO_APPS_SMMU_CB8_TLBIVAL_LOW_APPS_ADDR A:0x61e28620
y.create.l HWIO_APPS_SMMU_CB9_TLBIVAL_LOW_APPS_ADDR A:0x61e29620
y.create.l HWIO_APPS_SMMU_CB10_TLBIVAL_LOW_APPS_ADDR A:0x61e2a620
y.create.l HWIO_APPS_SMMU_CB11_TLBIVAL_LOW_APPS_ADDR A:0x61e2b620
y.create.l HWIO_APPS_SMMU_CB12_TLBIVAL_LOW_APPS_ADDR A:0x61e2c620
y.create.l HWIO_APPS_SMMU_CB13_TLBIVAL_LOW_APPS_ADDR A:0x61e2d620
y.create.l HWIO_APPS_SMMU_CB14_TLBIVAL_LOW_APPS_ADDR A:0x61e2e620
y.create.l HWIO_APPS_SMMU_CB15_TLBIVAL_LOW_APPS_ADDR A:0x61e2f620
y.create.l HWIO_APPS_SMMU_CB16_TLBIVAL_LOW_APPS_ADDR A:0x61e30620
y.create.l HWIO_APPS_SMMU_CB17_TLBIVAL_LOW_APPS_ADDR A:0x61e31620
y.create.l HWIO_APPS_SMMU_CB18_TLBIVAL_LOW_APPS_ADDR A:0x61e32620
y.create.l HWIO_APPS_SMMU_CB19_TLBIVAL_LOW_APPS_ADDR A:0x61e33620
y.create.l HWIO_APPS_SMMU_CB20_TLBIVAL_LOW_APPS_ADDR A:0x61e34620
y.create.l HWIO_APPS_SMMU_CB21_TLBIVAL_LOW_APPS_ADDR A:0x61e35620
y.create.l HWIO_APPS_SMMU_CB22_TLBIVAL_LOW_APPS_ADDR A:0x61e36620
y.create.l HWIO_APPS_SMMU_CB23_TLBIVAL_LOW_APPS_ADDR A:0x61e37620
y.create.l HWIO_APPS_SMMU_CB24_TLBIVAL_LOW_APPS_ADDR A:0x61e38620
y.create.l HWIO_APPS_SMMU_CB25_TLBIVAL_LOW_APPS_ADDR A:0x61e39620
y.create.l HWIO_APPS_SMMU_CB26_TLBIVAL_LOW_APPS_ADDR A:0x61e3a620
y.create.l HWIO_APPS_SMMU_CB27_TLBIVAL_LOW_APPS_ADDR A:0x61e3b620
y.create.l HWIO_APPS_SMMU_CB28_TLBIVAL_LOW_APPS_ADDR A:0x61e3c620
y.create.l HWIO_APPS_SMMU_CB29_TLBIVAL_LOW_APPS_ADDR A:0x61e3d620
y.create.l HWIO_APPS_SMMU_CB30_TLBIVAL_LOW_APPS_ADDR A:0x61e3e620
y.create.l HWIO_APPS_SMMU_CB31_TLBIVAL_LOW_APPS_ADDR A:0x61e3f620
y.create.l HWIO_APPS_SMMU_CB0_TLBIVAL_HIGH_APPS_ADDR A:0x61e20624
y.create.l HWIO_APPS_SMMU_CB1_TLBIVAL_HIGH_APPS_ADDR A:0x61e21624
y.create.l HWIO_APPS_SMMU_CB2_TLBIVAL_HIGH_APPS_ADDR A:0x61e22624
y.create.l HWIO_APPS_SMMU_CB3_TLBIVAL_HIGH_APPS_ADDR A:0x61e23624
y.create.l HWIO_APPS_SMMU_CB4_TLBIVAL_HIGH_APPS_ADDR A:0x61e24624
y.create.l HWIO_APPS_SMMU_CB5_TLBIVAL_HIGH_APPS_ADDR A:0x61e25624
y.create.l HWIO_APPS_SMMU_CB6_TLBIVAL_HIGH_APPS_ADDR A:0x61e26624
y.create.l HWIO_APPS_SMMU_CB7_TLBIVAL_HIGH_APPS_ADDR A:0x61e27624
y.create.l HWIO_APPS_SMMU_CB8_TLBIVAL_HIGH_APPS_ADDR A:0x61e28624
y.create.l HWIO_APPS_SMMU_CB9_TLBIVAL_HIGH_APPS_ADDR A:0x61e29624
y.create.l HWIO_APPS_SMMU_CB10_TLBIVAL_HIGH_APPS_ADDR A:0x61e2a624
y.create.l HWIO_APPS_SMMU_CB11_TLBIVAL_HIGH_APPS_ADDR A:0x61e2b624
y.create.l HWIO_APPS_SMMU_CB12_TLBIVAL_HIGH_APPS_ADDR A:0x61e2c624
y.create.l HWIO_APPS_SMMU_CB13_TLBIVAL_HIGH_APPS_ADDR A:0x61e2d624
y.create.l HWIO_APPS_SMMU_CB14_TLBIVAL_HIGH_APPS_ADDR A:0x61e2e624
y.create.l HWIO_APPS_SMMU_CB15_TLBIVAL_HIGH_APPS_ADDR A:0x61e2f624
y.create.l HWIO_APPS_SMMU_CB16_TLBIVAL_HIGH_APPS_ADDR A:0x61e30624
y.create.l HWIO_APPS_SMMU_CB17_TLBIVAL_HIGH_APPS_ADDR A:0x61e31624
y.create.l HWIO_APPS_SMMU_CB18_TLBIVAL_HIGH_APPS_ADDR A:0x61e32624
y.create.l HWIO_APPS_SMMU_CB19_TLBIVAL_HIGH_APPS_ADDR A:0x61e33624
y.create.l HWIO_APPS_SMMU_CB20_TLBIVAL_HIGH_APPS_ADDR A:0x61e34624
y.create.l HWIO_APPS_SMMU_CB21_TLBIVAL_HIGH_APPS_ADDR A:0x61e35624
y.create.l HWIO_APPS_SMMU_CB22_TLBIVAL_HIGH_APPS_ADDR A:0x61e36624
y.create.l HWIO_APPS_SMMU_CB23_TLBIVAL_HIGH_APPS_ADDR A:0x61e37624
y.create.l HWIO_APPS_SMMU_CB24_TLBIVAL_HIGH_APPS_ADDR A:0x61e38624
y.create.l HWIO_APPS_SMMU_CB25_TLBIVAL_HIGH_APPS_ADDR A:0x61e39624
y.create.l HWIO_APPS_SMMU_CB26_TLBIVAL_HIGH_APPS_ADDR A:0x61e3a624
y.create.l HWIO_APPS_SMMU_CB27_TLBIVAL_HIGH_APPS_ADDR A:0x61e3b624
y.create.l HWIO_APPS_SMMU_CB28_TLBIVAL_HIGH_APPS_ADDR A:0x61e3c624
y.create.l HWIO_APPS_SMMU_CB29_TLBIVAL_HIGH_APPS_ADDR A:0x61e3d624
y.create.l HWIO_APPS_SMMU_CB30_TLBIVAL_HIGH_APPS_ADDR A:0x61e3e624
y.create.l HWIO_APPS_SMMU_CB31_TLBIVAL_HIGH_APPS_ADDR A:0x61e3f624
y.create.l HWIO_APPS_SMMU_CB0_TLBIVAAL_LOW_APPS_ADDR A:0x61e20628
y.create.l HWIO_APPS_SMMU_CB1_TLBIVAAL_LOW_APPS_ADDR A:0x61e21628
y.create.l HWIO_APPS_SMMU_CB2_TLBIVAAL_LOW_APPS_ADDR A:0x61e22628
y.create.l HWIO_APPS_SMMU_CB3_TLBIVAAL_LOW_APPS_ADDR A:0x61e23628
y.create.l HWIO_APPS_SMMU_CB4_TLBIVAAL_LOW_APPS_ADDR A:0x61e24628
y.create.l HWIO_APPS_SMMU_CB5_TLBIVAAL_LOW_APPS_ADDR A:0x61e25628
y.create.l HWIO_APPS_SMMU_CB6_TLBIVAAL_LOW_APPS_ADDR A:0x61e26628
y.create.l HWIO_APPS_SMMU_CB7_TLBIVAAL_LOW_APPS_ADDR A:0x61e27628
y.create.l HWIO_APPS_SMMU_CB8_TLBIVAAL_LOW_APPS_ADDR A:0x61e28628
y.create.l HWIO_APPS_SMMU_CB9_TLBIVAAL_LOW_APPS_ADDR A:0x61e29628
y.create.l HWIO_APPS_SMMU_CB10_TLBIVAAL_LOW_APPS_ADDR A:0x61e2a628
y.create.l HWIO_APPS_SMMU_CB11_TLBIVAAL_LOW_APPS_ADDR A:0x61e2b628
y.create.l HWIO_APPS_SMMU_CB12_TLBIVAAL_LOW_APPS_ADDR A:0x61e2c628
y.create.l HWIO_APPS_SMMU_CB13_TLBIVAAL_LOW_APPS_ADDR A:0x61e2d628
y.create.l HWIO_APPS_SMMU_CB14_TLBIVAAL_LOW_APPS_ADDR A:0x61e2e628
y.create.l HWIO_APPS_SMMU_CB15_TLBIVAAL_LOW_APPS_ADDR A:0x61e2f628
y.create.l HWIO_APPS_SMMU_CB16_TLBIVAAL_LOW_APPS_ADDR A:0x61e30628
y.create.l HWIO_APPS_SMMU_CB17_TLBIVAAL_LOW_APPS_ADDR A:0x61e31628
y.create.l HWIO_APPS_SMMU_CB18_TLBIVAAL_LOW_APPS_ADDR A:0x61e32628
y.create.l HWIO_APPS_SMMU_CB19_TLBIVAAL_LOW_APPS_ADDR A:0x61e33628
y.create.l HWIO_APPS_SMMU_CB20_TLBIVAAL_LOW_APPS_ADDR A:0x61e34628
y.create.l HWIO_APPS_SMMU_CB21_TLBIVAAL_LOW_APPS_ADDR A:0x61e35628
y.create.l HWIO_APPS_SMMU_CB22_TLBIVAAL_LOW_APPS_ADDR A:0x61e36628
y.create.l HWIO_APPS_SMMU_CB23_TLBIVAAL_LOW_APPS_ADDR A:0x61e37628
y.create.l HWIO_APPS_SMMU_CB24_TLBIVAAL_LOW_APPS_ADDR A:0x61e38628
y.create.l HWIO_APPS_SMMU_CB25_TLBIVAAL_LOW_APPS_ADDR A:0x61e39628
y.create.l HWIO_APPS_SMMU_CB26_TLBIVAAL_LOW_APPS_ADDR A:0x61e3a628
y.create.l HWIO_APPS_SMMU_CB27_TLBIVAAL_LOW_APPS_ADDR A:0x61e3b628
y.create.l HWIO_APPS_SMMU_CB28_TLBIVAAL_LOW_APPS_ADDR A:0x61e3c628
y.create.l HWIO_APPS_SMMU_CB29_TLBIVAAL_LOW_APPS_ADDR A:0x61e3d628
y.create.l HWIO_APPS_SMMU_CB30_TLBIVAAL_LOW_APPS_ADDR A:0x61e3e628
y.create.l HWIO_APPS_SMMU_CB31_TLBIVAAL_LOW_APPS_ADDR A:0x61e3f628
y.create.l HWIO_APPS_SMMU_CB0_TLBIVAAL_HIGH_APPS_ADDR A:0x61e2062c
y.create.l HWIO_APPS_SMMU_CB1_TLBIVAAL_HIGH_APPS_ADDR A:0x61e2162c
y.create.l HWIO_APPS_SMMU_CB2_TLBIVAAL_HIGH_APPS_ADDR A:0x61e2262c
y.create.l HWIO_APPS_SMMU_CB3_TLBIVAAL_HIGH_APPS_ADDR A:0x61e2362c
y.create.l HWIO_APPS_SMMU_CB4_TLBIVAAL_HIGH_APPS_ADDR A:0x61e2462c
y.create.l HWIO_APPS_SMMU_CB5_TLBIVAAL_HIGH_APPS_ADDR A:0x61e2562c
y.create.l HWIO_APPS_SMMU_CB6_TLBIVAAL_HIGH_APPS_ADDR A:0x61e2662c
y.create.l HWIO_APPS_SMMU_CB7_TLBIVAAL_HIGH_APPS_ADDR A:0x61e2762c
y.create.l HWIO_APPS_SMMU_CB8_TLBIVAAL_HIGH_APPS_ADDR A:0x61e2862c
y.create.l HWIO_APPS_SMMU_CB9_TLBIVAAL_HIGH_APPS_ADDR A:0x61e2962c
y.create.l HWIO_APPS_SMMU_CB10_TLBIVAAL_HIGH_APPS_ADDR A:0x61e2a62c
y.create.l HWIO_APPS_SMMU_CB11_TLBIVAAL_HIGH_APPS_ADDR A:0x61e2b62c
y.create.l HWIO_APPS_SMMU_CB12_TLBIVAAL_HIGH_APPS_ADDR A:0x61e2c62c
y.create.l HWIO_APPS_SMMU_CB13_TLBIVAAL_HIGH_APPS_ADDR A:0x61e2d62c
y.create.l HWIO_APPS_SMMU_CB14_TLBIVAAL_HIGH_APPS_ADDR A:0x61e2e62c
y.create.l HWIO_APPS_SMMU_CB15_TLBIVAAL_HIGH_APPS_ADDR A:0x61e2f62c
y.create.l HWIO_APPS_SMMU_CB16_TLBIVAAL_HIGH_APPS_ADDR A:0x61e3062c
y.create.l HWIO_APPS_SMMU_CB17_TLBIVAAL_HIGH_APPS_ADDR A:0x61e3162c
y.create.l HWIO_APPS_SMMU_CB18_TLBIVAAL_HIGH_APPS_ADDR A:0x61e3262c
y.create.l HWIO_APPS_SMMU_CB19_TLBIVAAL_HIGH_APPS_ADDR A:0x61e3362c
y.create.l HWIO_APPS_SMMU_CB20_TLBIVAAL_HIGH_APPS_ADDR A:0x61e3462c
y.create.l HWIO_APPS_SMMU_CB21_TLBIVAAL_HIGH_APPS_ADDR A:0x61e3562c
y.create.l HWIO_APPS_SMMU_CB22_TLBIVAAL_HIGH_APPS_ADDR A:0x61e3662c
y.create.l HWIO_APPS_SMMU_CB23_TLBIVAAL_HIGH_APPS_ADDR A:0x61e3762c
y.create.l HWIO_APPS_SMMU_CB24_TLBIVAAL_HIGH_APPS_ADDR A:0x61e3862c
y.create.l HWIO_APPS_SMMU_CB25_TLBIVAAL_HIGH_APPS_ADDR A:0x61e3962c
y.create.l HWIO_APPS_SMMU_CB26_TLBIVAAL_HIGH_APPS_ADDR A:0x61e3a62c
y.create.l HWIO_APPS_SMMU_CB27_TLBIVAAL_HIGH_APPS_ADDR A:0x61e3b62c
y.create.l HWIO_APPS_SMMU_CB28_TLBIVAAL_HIGH_APPS_ADDR A:0x61e3c62c
y.create.l HWIO_APPS_SMMU_CB29_TLBIVAAL_HIGH_APPS_ADDR A:0x61e3d62c
y.create.l HWIO_APPS_SMMU_CB30_TLBIVAAL_HIGH_APPS_ADDR A:0x61e3e62c
y.create.l HWIO_APPS_SMMU_CB31_TLBIVAAL_HIGH_APPS_ADDR A:0x61e3f62c
y.create.l HWIO_APPS_SMMU_CB0_TLBIIPAS2_LOW_APPS_ADDR A:0x61e20630
y.create.l HWIO_APPS_SMMU_CB1_TLBIIPAS2_LOW_APPS_ADDR A:0x61e21630
y.create.l HWIO_APPS_SMMU_CB2_TLBIIPAS2_LOW_APPS_ADDR A:0x61e22630
y.create.l HWIO_APPS_SMMU_CB3_TLBIIPAS2_LOW_APPS_ADDR A:0x61e23630
y.create.l HWIO_APPS_SMMU_CB4_TLBIIPAS2_LOW_APPS_ADDR A:0x61e24630
y.create.l HWIO_APPS_SMMU_CB5_TLBIIPAS2_LOW_APPS_ADDR A:0x61e25630
y.create.l HWIO_APPS_SMMU_CB6_TLBIIPAS2_LOW_APPS_ADDR A:0x61e26630
y.create.l HWIO_APPS_SMMU_CB7_TLBIIPAS2_LOW_APPS_ADDR A:0x61e27630
y.create.l HWIO_APPS_SMMU_CB8_TLBIIPAS2_LOW_APPS_ADDR A:0x61e28630
y.create.l HWIO_APPS_SMMU_CB9_TLBIIPAS2_LOW_APPS_ADDR A:0x61e29630
y.create.l HWIO_APPS_SMMU_CB10_TLBIIPAS2_LOW_APPS_ADDR A:0x61e2a630
y.create.l HWIO_APPS_SMMU_CB11_TLBIIPAS2_LOW_APPS_ADDR A:0x61e2b630
y.create.l HWIO_APPS_SMMU_CB12_TLBIIPAS2_LOW_APPS_ADDR A:0x61e2c630
y.create.l HWIO_APPS_SMMU_CB13_TLBIIPAS2_LOW_APPS_ADDR A:0x61e2d630
y.create.l HWIO_APPS_SMMU_CB14_TLBIIPAS2_LOW_APPS_ADDR A:0x61e2e630
y.create.l HWIO_APPS_SMMU_CB15_TLBIIPAS2_LOW_APPS_ADDR A:0x61e2f630
y.create.l HWIO_APPS_SMMU_CB16_TLBIIPAS2_LOW_APPS_ADDR A:0x61e30630
y.create.l HWIO_APPS_SMMU_CB17_TLBIIPAS2_LOW_APPS_ADDR A:0x61e31630
y.create.l HWIO_APPS_SMMU_CB18_TLBIIPAS2_LOW_APPS_ADDR A:0x61e32630
y.create.l HWIO_APPS_SMMU_CB19_TLBIIPAS2_LOW_APPS_ADDR A:0x61e33630
y.create.l HWIO_APPS_SMMU_CB20_TLBIIPAS2_LOW_APPS_ADDR A:0x61e34630
y.create.l HWIO_APPS_SMMU_CB21_TLBIIPAS2_LOW_APPS_ADDR A:0x61e35630
y.create.l HWIO_APPS_SMMU_CB22_TLBIIPAS2_LOW_APPS_ADDR A:0x61e36630
y.create.l HWIO_APPS_SMMU_CB23_TLBIIPAS2_LOW_APPS_ADDR A:0x61e37630
y.create.l HWIO_APPS_SMMU_CB24_TLBIIPAS2_LOW_APPS_ADDR A:0x61e38630
y.create.l HWIO_APPS_SMMU_CB25_TLBIIPAS2_LOW_APPS_ADDR A:0x61e39630
y.create.l HWIO_APPS_SMMU_CB26_TLBIIPAS2_LOW_APPS_ADDR A:0x61e3a630
y.create.l HWIO_APPS_SMMU_CB27_TLBIIPAS2_LOW_APPS_ADDR A:0x61e3b630
y.create.l HWIO_APPS_SMMU_CB28_TLBIIPAS2_LOW_APPS_ADDR A:0x61e3c630
y.create.l HWIO_APPS_SMMU_CB29_TLBIIPAS2_LOW_APPS_ADDR A:0x61e3d630
y.create.l HWIO_APPS_SMMU_CB30_TLBIIPAS2_LOW_APPS_ADDR A:0x61e3e630
y.create.l HWIO_APPS_SMMU_CB31_TLBIIPAS2_LOW_APPS_ADDR A:0x61e3f630
y.create.l HWIO_APPS_SMMU_CB0_TLBIIPAS2_HIGH_APPS_ADDR A:0x61e20634
y.create.l HWIO_APPS_SMMU_CB1_TLBIIPAS2_HIGH_APPS_ADDR A:0x61e21634
y.create.l HWIO_APPS_SMMU_CB2_TLBIIPAS2_HIGH_APPS_ADDR A:0x61e22634
y.create.l HWIO_APPS_SMMU_CB3_TLBIIPAS2_HIGH_APPS_ADDR A:0x61e23634
y.create.l HWIO_APPS_SMMU_CB4_TLBIIPAS2_HIGH_APPS_ADDR A:0x61e24634
y.create.l HWIO_APPS_SMMU_CB5_TLBIIPAS2_HIGH_APPS_ADDR A:0x61e25634
y.create.l HWIO_APPS_SMMU_CB6_TLBIIPAS2_HIGH_APPS_ADDR A:0x61e26634
y.create.l HWIO_APPS_SMMU_CB7_TLBIIPAS2_HIGH_APPS_ADDR A:0x61e27634
y.create.l HWIO_APPS_SMMU_CB8_TLBIIPAS2_HIGH_APPS_ADDR A:0x61e28634
y.create.l HWIO_APPS_SMMU_CB9_TLBIIPAS2_HIGH_APPS_ADDR A:0x61e29634
y.create.l HWIO_APPS_SMMU_CB10_TLBIIPAS2_HIGH_APPS_ADDR A:0x61e2a634
y.create.l HWIO_APPS_SMMU_CB11_TLBIIPAS2_HIGH_APPS_ADDR A:0x61e2b634
y.create.l HWIO_APPS_SMMU_CB12_TLBIIPAS2_HIGH_APPS_ADDR A:0x61e2c634
y.create.l HWIO_APPS_SMMU_CB13_TLBIIPAS2_HIGH_APPS_ADDR A:0x61e2d634
y.create.l HWIO_APPS_SMMU_CB14_TLBIIPAS2_HIGH_APPS_ADDR A:0x61e2e634
y.create.l HWIO_APPS_SMMU_CB15_TLBIIPAS2_HIGH_APPS_ADDR A:0x61e2f634
y.create.l HWIO_APPS_SMMU_CB16_TLBIIPAS2_HIGH_APPS_ADDR A:0x61e30634
y.create.l HWIO_APPS_SMMU_CB17_TLBIIPAS2_HIGH_APPS_ADDR A:0x61e31634
y.create.l HWIO_APPS_SMMU_CB18_TLBIIPAS2_HIGH_APPS_ADDR A:0x61e32634
y.create.l HWIO_APPS_SMMU_CB19_TLBIIPAS2_HIGH_APPS_ADDR A:0x61e33634
y.create.l HWIO_APPS_SMMU_CB20_TLBIIPAS2_HIGH_APPS_ADDR A:0x61e34634
y.create.l HWIO_APPS_SMMU_CB21_TLBIIPAS2_HIGH_APPS_ADDR A:0x61e35634
y.create.l HWIO_APPS_SMMU_CB22_TLBIIPAS2_HIGH_APPS_ADDR A:0x61e36634
y.create.l HWIO_APPS_SMMU_CB23_TLBIIPAS2_HIGH_APPS_ADDR A:0x61e37634
y.create.l HWIO_APPS_SMMU_CB24_TLBIIPAS2_HIGH_APPS_ADDR A:0x61e38634
y.create.l HWIO_APPS_SMMU_CB25_TLBIIPAS2_HIGH_APPS_ADDR A:0x61e39634
y.create.l HWIO_APPS_SMMU_CB26_TLBIIPAS2_HIGH_APPS_ADDR A:0x61e3a634
y.create.l HWIO_APPS_SMMU_CB27_TLBIIPAS2_HIGH_APPS_ADDR A:0x61e3b634
y.create.l HWIO_APPS_SMMU_CB28_TLBIIPAS2_HIGH_APPS_ADDR A:0x61e3c634
y.create.l HWIO_APPS_SMMU_CB29_TLBIIPAS2_HIGH_APPS_ADDR A:0x61e3d634
y.create.l HWIO_APPS_SMMU_CB30_TLBIIPAS2_HIGH_APPS_ADDR A:0x61e3e634
y.create.l HWIO_APPS_SMMU_CB31_TLBIIPAS2_HIGH_APPS_ADDR A:0x61e3f634
y.create.l HWIO_APPS_SMMU_CB0_TLBIIPAS2L_LOW_APPS_ADDR A:0x61e20638
y.create.l HWIO_APPS_SMMU_CB1_TLBIIPAS2L_LOW_APPS_ADDR A:0x61e21638
y.create.l HWIO_APPS_SMMU_CB2_TLBIIPAS2L_LOW_APPS_ADDR A:0x61e22638
y.create.l HWIO_APPS_SMMU_CB3_TLBIIPAS2L_LOW_APPS_ADDR A:0x61e23638
y.create.l HWIO_APPS_SMMU_CB4_TLBIIPAS2L_LOW_APPS_ADDR A:0x61e24638
y.create.l HWIO_APPS_SMMU_CB5_TLBIIPAS2L_LOW_APPS_ADDR A:0x61e25638
y.create.l HWIO_APPS_SMMU_CB6_TLBIIPAS2L_LOW_APPS_ADDR A:0x61e26638
y.create.l HWIO_APPS_SMMU_CB7_TLBIIPAS2L_LOW_APPS_ADDR A:0x61e27638
y.create.l HWIO_APPS_SMMU_CB8_TLBIIPAS2L_LOW_APPS_ADDR A:0x61e28638
y.create.l HWIO_APPS_SMMU_CB9_TLBIIPAS2L_LOW_APPS_ADDR A:0x61e29638
y.create.l HWIO_APPS_SMMU_CB10_TLBIIPAS2L_LOW_APPS_ADDR A:0x61e2a638
y.create.l HWIO_APPS_SMMU_CB11_TLBIIPAS2L_LOW_APPS_ADDR A:0x61e2b638
y.create.l HWIO_APPS_SMMU_CB12_TLBIIPAS2L_LOW_APPS_ADDR A:0x61e2c638
y.create.l HWIO_APPS_SMMU_CB13_TLBIIPAS2L_LOW_APPS_ADDR A:0x61e2d638
y.create.l HWIO_APPS_SMMU_CB14_TLBIIPAS2L_LOW_APPS_ADDR A:0x61e2e638
y.create.l HWIO_APPS_SMMU_CB15_TLBIIPAS2L_LOW_APPS_ADDR A:0x61e2f638
y.create.l HWIO_APPS_SMMU_CB16_TLBIIPAS2L_LOW_APPS_ADDR A:0x61e30638
y.create.l HWIO_APPS_SMMU_CB17_TLBIIPAS2L_LOW_APPS_ADDR A:0x61e31638
y.create.l HWIO_APPS_SMMU_CB18_TLBIIPAS2L_LOW_APPS_ADDR A:0x61e32638
y.create.l HWIO_APPS_SMMU_CB19_TLBIIPAS2L_LOW_APPS_ADDR A:0x61e33638
y.create.l HWIO_APPS_SMMU_CB20_TLBIIPAS2L_LOW_APPS_ADDR A:0x61e34638
y.create.l HWIO_APPS_SMMU_CB21_TLBIIPAS2L_LOW_APPS_ADDR A:0x61e35638
y.create.l HWIO_APPS_SMMU_CB22_TLBIIPAS2L_LOW_APPS_ADDR A:0x61e36638
y.create.l HWIO_APPS_SMMU_CB23_TLBIIPAS2L_LOW_APPS_ADDR A:0x61e37638
y.create.l HWIO_APPS_SMMU_CB24_TLBIIPAS2L_LOW_APPS_ADDR A:0x61e38638
y.create.l HWIO_APPS_SMMU_CB25_TLBIIPAS2L_LOW_APPS_ADDR A:0x61e39638
y.create.l HWIO_APPS_SMMU_CB26_TLBIIPAS2L_LOW_APPS_ADDR A:0x61e3a638
y.create.l HWIO_APPS_SMMU_CB27_TLBIIPAS2L_LOW_APPS_ADDR A:0x61e3b638
y.create.l HWIO_APPS_SMMU_CB28_TLBIIPAS2L_LOW_APPS_ADDR A:0x61e3c638
y.create.l HWIO_APPS_SMMU_CB29_TLBIIPAS2L_LOW_APPS_ADDR A:0x61e3d638
y.create.l HWIO_APPS_SMMU_CB30_TLBIIPAS2L_LOW_APPS_ADDR A:0x61e3e638
y.create.l HWIO_APPS_SMMU_CB31_TLBIIPAS2L_LOW_APPS_ADDR A:0x61e3f638
y.create.l HWIO_APPS_SMMU_CB0_TLBIIPAS2L_HIGH_APPS_ADDR A:0x61e2063c
y.create.l HWIO_APPS_SMMU_CB1_TLBIIPAS2L_HIGH_APPS_ADDR A:0x61e2163c
y.create.l HWIO_APPS_SMMU_CB2_TLBIIPAS2L_HIGH_APPS_ADDR A:0x61e2263c
y.create.l HWIO_APPS_SMMU_CB3_TLBIIPAS2L_HIGH_APPS_ADDR A:0x61e2363c
y.create.l HWIO_APPS_SMMU_CB4_TLBIIPAS2L_HIGH_APPS_ADDR A:0x61e2463c
y.create.l HWIO_APPS_SMMU_CB5_TLBIIPAS2L_HIGH_APPS_ADDR A:0x61e2563c
y.create.l HWIO_APPS_SMMU_CB6_TLBIIPAS2L_HIGH_APPS_ADDR A:0x61e2663c
y.create.l HWIO_APPS_SMMU_CB7_TLBIIPAS2L_HIGH_APPS_ADDR A:0x61e2763c
y.create.l HWIO_APPS_SMMU_CB8_TLBIIPAS2L_HIGH_APPS_ADDR A:0x61e2863c
y.create.l HWIO_APPS_SMMU_CB9_TLBIIPAS2L_HIGH_APPS_ADDR A:0x61e2963c
y.create.l HWIO_APPS_SMMU_CB10_TLBIIPAS2L_HIGH_APPS_ADDR A:0x61e2a63c
y.create.l HWIO_APPS_SMMU_CB11_TLBIIPAS2L_HIGH_APPS_ADDR A:0x61e2b63c
y.create.l HWIO_APPS_SMMU_CB12_TLBIIPAS2L_HIGH_APPS_ADDR A:0x61e2c63c
y.create.l HWIO_APPS_SMMU_CB13_TLBIIPAS2L_HIGH_APPS_ADDR A:0x61e2d63c
y.create.l HWIO_APPS_SMMU_CB14_TLBIIPAS2L_HIGH_APPS_ADDR A:0x61e2e63c
y.create.l HWIO_APPS_SMMU_CB15_TLBIIPAS2L_HIGH_APPS_ADDR A:0x61e2f63c
y.create.l HWIO_APPS_SMMU_CB16_TLBIIPAS2L_HIGH_APPS_ADDR A:0x61e3063c
y.create.l HWIO_APPS_SMMU_CB17_TLBIIPAS2L_HIGH_APPS_ADDR A:0x61e3163c
y.create.l HWIO_APPS_SMMU_CB18_TLBIIPAS2L_HIGH_APPS_ADDR A:0x61e3263c
y.create.l HWIO_APPS_SMMU_CB19_TLBIIPAS2L_HIGH_APPS_ADDR A:0x61e3363c
y.create.l HWIO_APPS_SMMU_CB20_TLBIIPAS2L_HIGH_APPS_ADDR A:0x61e3463c
y.create.l HWIO_APPS_SMMU_CB21_TLBIIPAS2L_HIGH_APPS_ADDR A:0x61e3563c
y.create.l HWIO_APPS_SMMU_CB22_TLBIIPAS2L_HIGH_APPS_ADDR A:0x61e3663c
y.create.l HWIO_APPS_SMMU_CB23_TLBIIPAS2L_HIGH_APPS_ADDR A:0x61e3763c
y.create.l HWIO_APPS_SMMU_CB24_TLBIIPAS2L_HIGH_APPS_ADDR A:0x61e3863c
y.create.l HWIO_APPS_SMMU_CB25_TLBIIPAS2L_HIGH_APPS_ADDR A:0x61e3963c
y.create.l HWIO_APPS_SMMU_CB26_TLBIIPAS2L_HIGH_APPS_ADDR A:0x61e3a63c
y.create.l HWIO_APPS_SMMU_CB27_TLBIIPAS2L_HIGH_APPS_ADDR A:0x61e3b63c
y.create.l HWIO_APPS_SMMU_CB28_TLBIIPAS2L_HIGH_APPS_ADDR A:0x61e3c63c
y.create.l HWIO_APPS_SMMU_CB29_TLBIIPAS2L_HIGH_APPS_ADDR A:0x61e3d63c
y.create.l HWIO_APPS_SMMU_CB30_TLBIIPAS2L_HIGH_APPS_ADDR A:0x61e3e63c
y.create.l HWIO_APPS_SMMU_CB31_TLBIIPAS2L_HIGH_APPS_ADDR A:0x61e3f63c
y.create.l HWIO_APPS_SMMU_CB0_TLBSYNC_APPS_ADDR A:0x61e207f0
y.create.l HWIO_APPS_SMMU_CB1_TLBSYNC_APPS_ADDR A:0x61e217f0
y.create.l HWIO_APPS_SMMU_CB2_TLBSYNC_APPS_ADDR A:0x61e227f0
y.create.l HWIO_APPS_SMMU_CB3_TLBSYNC_APPS_ADDR A:0x61e237f0
y.create.l HWIO_APPS_SMMU_CB4_TLBSYNC_APPS_ADDR A:0x61e247f0
y.create.l HWIO_APPS_SMMU_CB5_TLBSYNC_APPS_ADDR A:0x61e257f0
y.create.l HWIO_APPS_SMMU_CB6_TLBSYNC_APPS_ADDR A:0x61e267f0
y.create.l HWIO_APPS_SMMU_CB7_TLBSYNC_APPS_ADDR A:0x61e277f0
y.create.l HWIO_APPS_SMMU_CB8_TLBSYNC_APPS_ADDR A:0x61e287f0
y.create.l HWIO_APPS_SMMU_CB9_TLBSYNC_APPS_ADDR A:0x61e297f0
y.create.l HWIO_APPS_SMMU_CB10_TLBSYNC_APPS_ADDR A:0x61e2a7f0
y.create.l HWIO_APPS_SMMU_CB11_TLBSYNC_APPS_ADDR A:0x61e2b7f0
y.create.l HWIO_APPS_SMMU_CB12_TLBSYNC_APPS_ADDR A:0x61e2c7f0
y.create.l HWIO_APPS_SMMU_CB13_TLBSYNC_APPS_ADDR A:0x61e2d7f0
y.create.l HWIO_APPS_SMMU_CB14_TLBSYNC_APPS_ADDR A:0x61e2e7f0
y.create.l HWIO_APPS_SMMU_CB15_TLBSYNC_APPS_ADDR A:0x61e2f7f0
y.create.l HWIO_APPS_SMMU_CB16_TLBSYNC_APPS_ADDR A:0x61e307f0
y.create.l HWIO_APPS_SMMU_CB17_TLBSYNC_APPS_ADDR A:0x61e317f0
y.create.l HWIO_APPS_SMMU_CB18_TLBSYNC_APPS_ADDR A:0x61e327f0
y.create.l HWIO_APPS_SMMU_CB19_TLBSYNC_APPS_ADDR A:0x61e337f0
y.create.l HWIO_APPS_SMMU_CB20_TLBSYNC_APPS_ADDR A:0x61e347f0
y.create.l HWIO_APPS_SMMU_CB21_TLBSYNC_APPS_ADDR A:0x61e357f0
y.create.l HWIO_APPS_SMMU_CB22_TLBSYNC_APPS_ADDR A:0x61e367f0
y.create.l HWIO_APPS_SMMU_CB23_TLBSYNC_APPS_ADDR A:0x61e377f0
y.create.l HWIO_APPS_SMMU_CB24_TLBSYNC_APPS_ADDR A:0x61e387f0
y.create.l HWIO_APPS_SMMU_CB25_TLBSYNC_APPS_ADDR A:0x61e397f0
y.create.l HWIO_APPS_SMMU_CB26_TLBSYNC_APPS_ADDR A:0x61e3a7f0
y.create.l HWIO_APPS_SMMU_CB27_TLBSYNC_APPS_ADDR A:0x61e3b7f0
y.create.l HWIO_APPS_SMMU_CB28_TLBSYNC_APPS_ADDR A:0x61e3c7f0
y.create.l HWIO_APPS_SMMU_CB29_TLBSYNC_APPS_ADDR A:0x61e3d7f0
y.create.l HWIO_APPS_SMMU_CB30_TLBSYNC_APPS_ADDR A:0x61e3e7f0
y.create.l HWIO_APPS_SMMU_CB31_TLBSYNC_APPS_ADDR A:0x61e3f7f0
y.create.l HWIO_APPS_SMMU_CB0_TLBSTATUS_APPS_ADDR A:0x61e207f4
y.create.l HWIO_APPS_SMMU_CB1_TLBSTATUS_APPS_ADDR A:0x61e217f4
y.create.l HWIO_APPS_SMMU_CB2_TLBSTATUS_APPS_ADDR A:0x61e227f4
y.create.l HWIO_APPS_SMMU_CB3_TLBSTATUS_APPS_ADDR A:0x61e237f4
y.create.l HWIO_APPS_SMMU_CB4_TLBSTATUS_APPS_ADDR A:0x61e247f4
y.create.l HWIO_APPS_SMMU_CB5_TLBSTATUS_APPS_ADDR A:0x61e257f4
y.create.l HWIO_APPS_SMMU_CB6_TLBSTATUS_APPS_ADDR A:0x61e267f4
y.create.l HWIO_APPS_SMMU_CB7_TLBSTATUS_APPS_ADDR A:0x61e277f4
y.create.l HWIO_APPS_SMMU_CB8_TLBSTATUS_APPS_ADDR A:0x61e287f4
y.create.l HWIO_APPS_SMMU_CB9_TLBSTATUS_APPS_ADDR A:0x61e297f4
y.create.l HWIO_APPS_SMMU_CB10_TLBSTATUS_APPS_ADDR A:0x61e2a7f4
y.create.l HWIO_APPS_SMMU_CB11_TLBSTATUS_APPS_ADDR A:0x61e2b7f4
y.create.l HWIO_APPS_SMMU_CB12_TLBSTATUS_APPS_ADDR A:0x61e2c7f4
y.create.l HWIO_APPS_SMMU_CB13_TLBSTATUS_APPS_ADDR A:0x61e2d7f4
y.create.l HWIO_APPS_SMMU_CB14_TLBSTATUS_APPS_ADDR A:0x61e2e7f4
y.create.l HWIO_APPS_SMMU_CB15_TLBSTATUS_APPS_ADDR A:0x61e2f7f4
y.create.l HWIO_APPS_SMMU_CB16_TLBSTATUS_APPS_ADDR A:0x61e307f4
y.create.l HWIO_APPS_SMMU_CB17_TLBSTATUS_APPS_ADDR A:0x61e317f4
y.create.l HWIO_APPS_SMMU_CB18_TLBSTATUS_APPS_ADDR A:0x61e327f4
y.create.l HWIO_APPS_SMMU_CB19_TLBSTATUS_APPS_ADDR A:0x61e337f4
y.create.l HWIO_APPS_SMMU_CB20_TLBSTATUS_APPS_ADDR A:0x61e347f4
y.create.l HWIO_APPS_SMMU_CB21_TLBSTATUS_APPS_ADDR A:0x61e357f4
y.create.l HWIO_APPS_SMMU_CB22_TLBSTATUS_APPS_ADDR A:0x61e367f4
y.create.l HWIO_APPS_SMMU_CB23_TLBSTATUS_APPS_ADDR A:0x61e377f4
y.create.l HWIO_APPS_SMMU_CB24_TLBSTATUS_APPS_ADDR A:0x61e387f4
y.create.l HWIO_APPS_SMMU_CB25_TLBSTATUS_APPS_ADDR A:0x61e397f4
y.create.l HWIO_APPS_SMMU_CB26_TLBSTATUS_APPS_ADDR A:0x61e3a7f4
y.create.l HWIO_APPS_SMMU_CB27_TLBSTATUS_APPS_ADDR A:0x61e3b7f4
y.create.l HWIO_APPS_SMMU_CB28_TLBSTATUS_APPS_ADDR A:0x61e3c7f4
y.create.l HWIO_APPS_SMMU_CB29_TLBSTATUS_APPS_ADDR A:0x61e3d7f4
y.create.l HWIO_APPS_SMMU_CB30_TLBSTATUS_APPS_ADDR A:0x61e3e7f4
y.create.l HWIO_APPS_SMMU_CB31_TLBSTATUS_APPS_ADDR A:0x61e3f7f4
y.create.l HWIO_APPS_SMMU_CB0_PMEVCNTR0_APPS_ADDR A:0x61e20e00
y.create.l HWIO_APPS_SMMU_CB1_PMEVCNTR0_APPS_ADDR A:0x61e21e00
y.create.l HWIO_APPS_SMMU_CB2_PMEVCNTR0_APPS_ADDR A:0x61e22e00
y.create.l HWIO_APPS_SMMU_CB3_PMEVCNTR0_APPS_ADDR A:0x61e23e00
y.create.l HWIO_APPS_SMMU_CB4_PMEVCNTR0_APPS_ADDR A:0x61e24e00
y.create.l HWIO_APPS_SMMU_CB5_PMEVCNTR0_APPS_ADDR A:0x61e25e00
y.create.l HWIO_APPS_SMMU_CB6_PMEVCNTR0_APPS_ADDR A:0x61e26e00
y.create.l HWIO_APPS_SMMU_CB7_PMEVCNTR0_APPS_ADDR A:0x61e27e00
y.create.l HWIO_APPS_SMMU_CB8_PMEVCNTR0_APPS_ADDR A:0x61e28e00
y.create.l HWIO_APPS_SMMU_CB9_PMEVCNTR0_APPS_ADDR A:0x61e29e00
y.create.l HWIO_APPS_SMMU_CB10_PMEVCNTR0_APPS_ADDR A:0x61e2ae00
y.create.l HWIO_APPS_SMMU_CB11_PMEVCNTR0_APPS_ADDR A:0x61e2be00
y.create.l HWIO_APPS_SMMU_CB12_PMEVCNTR0_APPS_ADDR A:0x61e2ce00
y.create.l HWIO_APPS_SMMU_CB13_PMEVCNTR0_APPS_ADDR A:0x61e2de00
y.create.l HWIO_APPS_SMMU_CB14_PMEVCNTR0_APPS_ADDR A:0x61e2ee00
y.create.l HWIO_APPS_SMMU_CB15_PMEVCNTR0_APPS_ADDR A:0x61e2fe00
y.create.l HWIO_APPS_SMMU_CB16_PMEVCNTR0_APPS_ADDR A:0x61e30e00
y.create.l HWIO_APPS_SMMU_CB17_PMEVCNTR0_APPS_ADDR A:0x61e31e00
y.create.l HWIO_APPS_SMMU_CB18_PMEVCNTR0_APPS_ADDR A:0x61e32e00
y.create.l HWIO_APPS_SMMU_CB19_PMEVCNTR0_APPS_ADDR A:0x61e33e00
y.create.l HWIO_APPS_SMMU_CB20_PMEVCNTR0_APPS_ADDR A:0x61e34e00
y.create.l HWIO_APPS_SMMU_CB21_PMEVCNTR0_APPS_ADDR A:0x61e35e00
y.create.l HWIO_APPS_SMMU_CB22_PMEVCNTR0_APPS_ADDR A:0x61e36e00
y.create.l HWIO_APPS_SMMU_CB23_PMEVCNTR0_APPS_ADDR A:0x61e37e00
y.create.l HWIO_APPS_SMMU_CB24_PMEVCNTR0_APPS_ADDR A:0x61e38e00
y.create.l HWIO_APPS_SMMU_CB25_PMEVCNTR0_APPS_ADDR A:0x61e39e00
y.create.l HWIO_APPS_SMMU_CB26_PMEVCNTR0_APPS_ADDR A:0x61e3ae00
y.create.l HWIO_APPS_SMMU_CB27_PMEVCNTR0_APPS_ADDR A:0x61e3be00
y.create.l HWIO_APPS_SMMU_CB28_PMEVCNTR0_APPS_ADDR A:0x61e3ce00
y.create.l HWIO_APPS_SMMU_CB29_PMEVCNTR0_APPS_ADDR A:0x61e3de00
y.create.l HWIO_APPS_SMMU_CB30_PMEVCNTR0_APPS_ADDR A:0x61e3ee00
y.create.l HWIO_APPS_SMMU_CB31_PMEVCNTR0_APPS_ADDR A:0x61e3fe00
y.create.l HWIO_APPS_SMMU_CB0_PMEVCNTR1_APPS_ADDR A:0x61e20e04
y.create.l HWIO_APPS_SMMU_CB1_PMEVCNTR1_APPS_ADDR A:0x61e21e04
y.create.l HWIO_APPS_SMMU_CB2_PMEVCNTR1_APPS_ADDR A:0x61e22e04
y.create.l HWIO_APPS_SMMU_CB3_PMEVCNTR1_APPS_ADDR A:0x61e23e04
y.create.l HWIO_APPS_SMMU_CB4_PMEVCNTR1_APPS_ADDR A:0x61e24e04
y.create.l HWIO_APPS_SMMU_CB5_PMEVCNTR1_APPS_ADDR A:0x61e25e04
y.create.l HWIO_APPS_SMMU_CB6_PMEVCNTR1_APPS_ADDR A:0x61e26e04
y.create.l HWIO_APPS_SMMU_CB7_PMEVCNTR1_APPS_ADDR A:0x61e27e04
y.create.l HWIO_APPS_SMMU_CB8_PMEVCNTR1_APPS_ADDR A:0x61e28e04
y.create.l HWIO_APPS_SMMU_CB9_PMEVCNTR1_APPS_ADDR A:0x61e29e04
y.create.l HWIO_APPS_SMMU_CB10_PMEVCNTR1_APPS_ADDR A:0x61e2ae04
y.create.l HWIO_APPS_SMMU_CB11_PMEVCNTR1_APPS_ADDR A:0x61e2be04
y.create.l HWIO_APPS_SMMU_CB12_PMEVCNTR1_APPS_ADDR A:0x61e2ce04
y.create.l HWIO_APPS_SMMU_CB13_PMEVCNTR1_APPS_ADDR A:0x61e2de04
y.create.l HWIO_APPS_SMMU_CB14_PMEVCNTR1_APPS_ADDR A:0x61e2ee04
y.create.l HWIO_APPS_SMMU_CB15_PMEVCNTR1_APPS_ADDR A:0x61e2fe04
y.create.l HWIO_APPS_SMMU_CB16_PMEVCNTR1_APPS_ADDR A:0x61e30e04
y.create.l HWIO_APPS_SMMU_CB17_PMEVCNTR1_APPS_ADDR A:0x61e31e04
y.create.l HWIO_APPS_SMMU_CB18_PMEVCNTR1_APPS_ADDR A:0x61e32e04
y.create.l HWIO_APPS_SMMU_CB19_PMEVCNTR1_APPS_ADDR A:0x61e33e04
y.create.l HWIO_APPS_SMMU_CB20_PMEVCNTR1_APPS_ADDR A:0x61e34e04
y.create.l HWIO_APPS_SMMU_CB21_PMEVCNTR1_APPS_ADDR A:0x61e35e04
y.create.l HWIO_APPS_SMMU_CB22_PMEVCNTR1_APPS_ADDR A:0x61e36e04
y.create.l HWIO_APPS_SMMU_CB23_PMEVCNTR1_APPS_ADDR A:0x61e37e04
y.create.l HWIO_APPS_SMMU_CB24_PMEVCNTR1_APPS_ADDR A:0x61e38e04
y.create.l HWIO_APPS_SMMU_CB25_PMEVCNTR1_APPS_ADDR A:0x61e39e04
y.create.l HWIO_APPS_SMMU_CB26_PMEVCNTR1_APPS_ADDR A:0x61e3ae04
y.create.l HWIO_APPS_SMMU_CB27_PMEVCNTR1_APPS_ADDR A:0x61e3be04
y.create.l HWIO_APPS_SMMU_CB28_PMEVCNTR1_APPS_ADDR A:0x61e3ce04
y.create.l HWIO_APPS_SMMU_CB29_PMEVCNTR1_APPS_ADDR A:0x61e3de04
y.create.l HWIO_APPS_SMMU_CB30_PMEVCNTR1_APPS_ADDR A:0x61e3ee04
y.create.l HWIO_APPS_SMMU_CB31_PMEVCNTR1_APPS_ADDR A:0x61e3fe04
y.create.l HWIO_APPS_SMMU_CB0_PMEVCNTR2_APPS_ADDR A:0x61e20e08
y.create.l HWIO_APPS_SMMU_CB1_PMEVCNTR2_APPS_ADDR A:0x61e21e08
y.create.l HWIO_APPS_SMMU_CB2_PMEVCNTR2_APPS_ADDR A:0x61e22e08
y.create.l HWIO_APPS_SMMU_CB3_PMEVCNTR2_APPS_ADDR A:0x61e23e08
y.create.l HWIO_APPS_SMMU_CB4_PMEVCNTR2_APPS_ADDR A:0x61e24e08
y.create.l HWIO_APPS_SMMU_CB5_PMEVCNTR2_APPS_ADDR A:0x61e25e08
y.create.l HWIO_APPS_SMMU_CB6_PMEVCNTR2_APPS_ADDR A:0x61e26e08
y.create.l HWIO_APPS_SMMU_CB7_PMEVCNTR2_APPS_ADDR A:0x61e27e08
y.create.l HWIO_APPS_SMMU_CB8_PMEVCNTR2_APPS_ADDR A:0x61e28e08
y.create.l HWIO_APPS_SMMU_CB9_PMEVCNTR2_APPS_ADDR A:0x61e29e08
y.create.l HWIO_APPS_SMMU_CB10_PMEVCNTR2_APPS_ADDR A:0x61e2ae08
y.create.l HWIO_APPS_SMMU_CB11_PMEVCNTR2_APPS_ADDR A:0x61e2be08
y.create.l HWIO_APPS_SMMU_CB12_PMEVCNTR2_APPS_ADDR A:0x61e2ce08
y.create.l HWIO_APPS_SMMU_CB13_PMEVCNTR2_APPS_ADDR A:0x61e2de08
y.create.l HWIO_APPS_SMMU_CB14_PMEVCNTR2_APPS_ADDR A:0x61e2ee08
y.create.l HWIO_APPS_SMMU_CB15_PMEVCNTR2_APPS_ADDR A:0x61e2fe08
y.create.l HWIO_APPS_SMMU_CB16_PMEVCNTR2_APPS_ADDR A:0x61e30e08
y.create.l HWIO_APPS_SMMU_CB17_PMEVCNTR2_APPS_ADDR A:0x61e31e08
y.create.l HWIO_APPS_SMMU_CB18_PMEVCNTR2_APPS_ADDR A:0x61e32e08
y.create.l HWIO_APPS_SMMU_CB19_PMEVCNTR2_APPS_ADDR A:0x61e33e08
y.create.l HWIO_APPS_SMMU_CB20_PMEVCNTR2_APPS_ADDR A:0x61e34e08
y.create.l HWIO_APPS_SMMU_CB21_PMEVCNTR2_APPS_ADDR A:0x61e35e08
y.create.l HWIO_APPS_SMMU_CB22_PMEVCNTR2_APPS_ADDR A:0x61e36e08
y.create.l HWIO_APPS_SMMU_CB23_PMEVCNTR2_APPS_ADDR A:0x61e37e08
y.create.l HWIO_APPS_SMMU_CB24_PMEVCNTR2_APPS_ADDR A:0x61e38e08
y.create.l HWIO_APPS_SMMU_CB25_PMEVCNTR2_APPS_ADDR A:0x61e39e08
y.create.l HWIO_APPS_SMMU_CB26_PMEVCNTR2_APPS_ADDR A:0x61e3ae08
y.create.l HWIO_APPS_SMMU_CB27_PMEVCNTR2_APPS_ADDR A:0x61e3be08
y.create.l HWIO_APPS_SMMU_CB28_PMEVCNTR2_APPS_ADDR A:0x61e3ce08
y.create.l HWIO_APPS_SMMU_CB29_PMEVCNTR2_APPS_ADDR A:0x61e3de08
y.create.l HWIO_APPS_SMMU_CB30_PMEVCNTR2_APPS_ADDR A:0x61e3ee08
y.create.l HWIO_APPS_SMMU_CB31_PMEVCNTR2_APPS_ADDR A:0x61e3fe08
y.create.l HWIO_APPS_SMMU_CB0_PMEVCNTR3_APPS_ADDR A:0x61e20e0c
y.create.l HWIO_APPS_SMMU_CB1_PMEVCNTR3_APPS_ADDR A:0x61e21e0c
y.create.l HWIO_APPS_SMMU_CB2_PMEVCNTR3_APPS_ADDR A:0x61e22e0c
y.create.l HWIO_APPS_SMMU_CB3_PMEVCNTR3_APPS_ADDR A:0x61e23e0c
y.create.l HWIO_APPS_SMMU_CB4_PMEVCNTR3_APPS_ADDR A:0x61e24e0c
y.create.l HWIO_APPS_SMMU_CB5_PMEVCNTR3_APPS_ADDR A:0x61e25e0c
y.create.l HWIO_APPS_SMMU_CB6_PMEVCNTR3_APPS_ADDR A:0x61e26e0c
y.create.l HWIO_APPS_SMMU_CB7_PMEVCNTR3_APPS_ADDR A:0x61e27e0c
y.create.l HWIO_APPS_SMMU_CB8_PMEVCNTR3_APPS_ADDR A:0x61e28e0c
y.create.l HWIO_APPS_SMMU_CB9_PMEVCNTR3_APPS_ADDR A:0x61e29e0c
y.create.l HWIO_APPS_SMMU_CB10_PMEVCNTR3_APPS_ADDR A:0x61e2ae0c
y.create.l HWIO_APPS_SMMU_CB11_PMEVCNTR3_APPS_ADDR A:0x61e2be0c
y.create.l HWIO_APPS_SMMU_CB12_PMEVCNTR3_APPS_ADDR A:0x61e2ce0c
y.create.l HWIO_APPS_SMMU_CB13_PMEVCNTR3_APPS_ADDR A:0x61e2de0c
y.create.l HWIO_APPS_SMMU_CB14_PMEVCNTR3_APPS_ADDR A:0x61e2ee0c
y.create.l HWIO_APPS_SMMU_CB15_PMEVCNTR3_APPS_ADDR A:0x61e2fe0c
y.create.l HWIO_APPS_SMMU_CB16_PMEVCNTR3_APPS_ADDR A:0x61e30e0c
y.create.l HWIO_APPS_SMMU_CB17_PMEVCNTR3_APPS_ADDR A:0x61e31e0c
y.create.l HWIO_APPS_SMMU_CB18_PMEVCNTR3_APPS_ADDR A:0x61e32e0c
y.create.l HWIO_APPS_SMMU_CB19_PMEVCNTR3_APPS_ADDR A:0x61e33e0c
y.create.l HWIO_APPS_SMMU_CB20_PMEVCNTR3_APPS_ADDR A:0x61e34e0c
y.create.l HWIO_APPS_SMMU_CB21_PMEVCNTR3_APPS_ADDR A:0x61e35e0c
y.create.l HWIO_APPS_SMMU_CB22_PMEVCNTR3_APPS_ADDR A:0x61e36e0c
y.create.l HWIO_APPS_SMMU_CB23_PMEVCNTR3_APPS_ADDR A:0x61e37e0c
y.create.l HWIO_APPS_SMMU_CB24_PMEVCNTR3_APPS_ADDR A:0x61e38e0c
y.create.l HWIO_APPS_SMMU_CB25_PMEVCNTR3_APPS_ADDR A:0x61e39e0c
y.create.l HWIO_APPS_SMMU_CB26_PMEVCNTR3_APPS_ADDR A:0x61e3ae0c
y.create.l HWIO_APPS_SMMU_CB27_PMEVCNTR3_APPS_ADDR A:0x61e3be0c
y.create.l HWIO_APPS_SMMU_CB28_PMEVCNTR3_APPS_ADDR A:0x61e3ce0c
y.create.l HWIO_APPS_SMMU_CB29_PMEVCNTR3_APPS_ADDR A:0x61e3de0c
y.create.l HWIO_APPS_SMMU_CB30_PMEVCNTR3_APPS_ADDR A:0x61e3ee0c
y.create.l HWIO_APPS_SMMU_CB31_PMEVCNTR3_APPS_ADDR A:0x61e3fe0c
y.create.l HWIO_APPS_SMMU_CB0_PMEVTYPER0_APPS_ADDR A:0x61e20e80
y.create.l HWIO_APPS_SMMU_CB1_PMEVTYPER0_APPS_ADDR A:0x61e21e80
y.create.l HWIO_APPS_SMMU_CB2_PMEVTYPER0_APPS_ADDR A:0x61e22e80
y.create.l HWIO_APPS_SMMU_CB3_PMEVTYPER0_APPS_ADDR A:0x61e23e80
y.create.l HWIO_APPS_SMMU_CB4_PMEVTYPER0_APPS_ADDR A:0x61e24e80
y.create.l HWIO_APPS_SMMU_CB5_PMEVTYPER0_APPS_ADDR A:0x61e25e80
y.create.l HWIO_APPS_SMMU_CB6_PMEVTYPER0_APPS_ADDR A:0x61e26e80
y.create.l HWIO_APPS_SMMU_CB7_PMEVTYPER0_APPS_ADDR A:0x61e27e80
y.create.l HWIO_APPS_SMMU_CB8_PMEVTYPER0_APPS_ADDR A:0x61e28e80
y.create.l HWIO_APPS_SMMU_CB9_PMEVTYPER0_APPS_ADDR A:0x61e29e80
y.create.l HWIO_APPS_SMMU_CB10_PMEVTYPER0_APPS_ADDR A:0x61e2ae80
y.create.l HWIO_APPS_SMMU_CB11_PMEVTYPER0_APPS_ADDR A:0x61e2be80
y.create.l HWIO_APPS_SMMU_CB12_PMEVTYPER0_APPS_ADDR A:0x61e2ce80
y.create.l HWIO_APPS_SMMU_CB13_PMEVTYPER0_APPS_ADDR A:0x61e2de80
y.create.l HWIO_APPS_SMMU_CB14_PMEVTYPER0_APPS_ADDR A:0x61e2ee80
y.create.l HWIO_APPS_SMMU_CB15_PMEVTYPER0_APPS_ADDR A:0x61e2fe80
y.create.l HWIO_APPS_SMMU_CB16_PMEVTYPER0_APPS_ADDR A:0x61e30e80
y.create.l HWIO_APPS_SMMU_CB17_PMEVTYPER0_APPS_ADDR A:0x61e31e80
y.create.l HWIO_APPS_SMMU_CB18_PMEVTYPER0_APPS_ADDR A:0x61e32e80
y.create.l HWIO_APPS_SMMU_CB19_PMEVTYPER0_APPS_ADDR A:0x61e33e80
y.create.l HWIO_APPS_SMMU_CB20_PMEVTYPER0_APPS_ADDR A:0x61e34e80
y.create.l HWIO_APPS_SMMU_CB21_PMEVTYPER0_APPS_ADDR A:0x61e35e80
y.create.l HWIO_APPS_SMMU_CB22_PMEVTYPER0_APPS_ADDR A:0x61e36e80
y.create.l HWIO_APPS_SMMU_CB23_PMEVTYPER0_APPS_ADDR A:0x61e37e80
y.create.l HWIO_APPS_SMMU_CB24_PMEVTYPER0_APPS_ADDR A:0x61e38e80
y.create.l HWIO_APPS_SMMU_CB25_PMEVTYPER0_APPS_ADDR A:0x61e39e80
y.create.l HWIO_APPS_SMMU_CB26_PMEVTYPER0_APPS_ADDR A:0x61e3ae80
y.create.l HWIO_APPS_SMMU_CB27_PMEVTYPER0_APPS_ADDR A:0x61e3be80
y.create.l HWIO_APPS_SMMU_CB28_PMEVTYPER0_APPS_ADDR A:0x61e3ce80
y.create.l HWIO_APPS_SMMU_CB29_PMEVTYPER0_APPS_ADDR A:0x61e3de80
y.create.l HWIO_APPS_SMMU_CB30_PMEVTYPER0_APPS_ADDR A:0x61e3ee80
y.create.l HWIO_APPS_SMMU_CB31_PMEVTYPER0_APPS_ADDR A:0x61e3fe80
y.create.l HWIO_APPS_SMMU_CB0_PMEVTYPER1_APPS_ADDR A:0x61e20e84
y.create.l HWIO_APPS_SMMU_CB1_PMEVTYPER1_APPS_ADDR A:0x61e21e84
y.create.l HWIO_APPS_SMMU_CB2_PMEVTYPER1_APPS_ADDR A:0x61e22e84
y.create.l HWIO_APPS_SMMU_CB3_PMEVTYPER1_APPS_ADDR A:0x61e23e84
y.create.l HWIO_APPS_SMMU_CB4_PMEVTYPER1_APPS_ADDR A:0x61e24e84
y.create.l HWIO_APPS_SMMU_CB5_PMEVTYPER1_APPS_ADDR A:0x61e25e84
y.create.l HWIO_APPS_SMMU_CB6_PMEVTYPER1_APPS_ADDR A:0x61e26e84
y.create.l HWIO_APPS_SMMU_CB7_PMEVTYPER1_APPS_ADDR A:0x61e27e84
y.create.l HWIO_APPS_SMMU_CB8_PMEVTYPER1_APPS_ADDR A:0x61e28e84
y.create.l HWIO_APPS_SMMU_CB9_PMEVTYPER1_APPS_ADDR A:0x61e29e84
y.create.l HWIO_APPS_SMMU_CB10_PMEVTYPER1_APPS_ADDR A:0x61e2ae84
y.create.l HWIO_APPS_SMMU_CB11_PMEVTYPER1_APPS_ADDR A:0x61e2be84
y.create.l HWIO_APPS_SMMU_CB12_PMEVTYPER1_APPS_ADDR A:0x61e2ce84
y.create.l HWIO_APPS_SMMU_CB13_PMEVTYPER1_APPS_ADDR A:0x61e2de84
y.create.l HWIO_APPS_SMMU_CB14_PMEVTYPER1_APPS_ADDR A:0x61e2ee84
y.create.l HWIO_APPS_SMMU_CB15_PMEVTYPER1_APPS_ADDR A:0x61e2fe84
y.create.l HWIO_APPS_SMMU_CB16_PMEVTYPER1_APPS_ADDR A:0x61e30e84
y.create.l HWIO_APPS_SMMU_CB17_PMEVTYPER1_APPS_ADDR A:0x61e31e84
y.create.l HWIO_APPS_SMMU_CB18_PMEVTYPER1_APPS_ADDR A:0x61e32e84
y.create.l HWIO_APPS_SMMU_CB19_PMEVTYPER1_APPS_ADDR A:0x61e33e84
y.create.l HWIO_APPS_SMMU_CB20_PMEVTYPER1_APPS_ADDR A:0x61e34e84
y.create.l HWIO_APPS_SMMU_CB21_PMEVTYPER1_APPS_ADDR A:0x61e35e84
y.create.l HWIO_APPS_SMMU_CB22_PMEVTYPER1_APPS_ADDR A:0x61e36e84
y.create.l HWIO_APPS_SMMU_CB23_PMEVTYPER1_APPS_ADDR A:0x61e37e84
y.create.l HWIO_APPS_SMMU_CB24_PMEVTYPER1_APPS_ADDR A:0x61e38e84
y.create.l HWIO_APPS_SMMU_CB25_PMEVTYPER1_APPS_ADDR A:0x61e39e84
y.create.l HWIO_APPS_SMMU_CB26_PMEVTYPER1_APPS_ADDR A:0x61e3ae84
y.create.l HWIO_APPS_SMMU_CB27_PMEVTYPER1_APPS_ADDR A:0x61e3be84
y.create.l HWIO_APPS_SMMU_CB28_PMEVTYPER1_APPS_ADDR A:0x61e3ce84
y.create.l HWIO_APPS_SMMU_CB29_PMEVTYPER1_APPS_ADDR A:0x61e3de84
y.create.l HWIO_APPS_SMMU_CB30_PMEVTYPER1_APPS_ADDR A:0x61e3ee84
y.create.l HWIO_APPS_SMMU_CB31_PMEVTYPER1_APPS_ADDR A:0x61e3fe84
y.create.l HWIO_APPS_SMMU_CB0_PMEVTYPER2_APPS_ADDR A:0x61e20e88
y.create.l HWIO_APPS_SMMU_CB1_PMEVTYPER2_APPS_ADDR A:0x61e21e88
y.create.l HWIO_APPS_SMMU_CB2_PMEVTYPER2_APPS_ADDR A:0x61e22e88
y.create.l HWIO_APPS_SMMU_CB3_PMEVTYPER2_APPS_ADDR A:0x61e23e88
y.create.l HWIO_APPS_SMMU_CB4_PMEVTYPER2_APPS_ADDR A:0x61e24e88
y.create.l HWIO_APPS_SMMU_CB5_PMEVTYPER2_APPS_ADDR A:0x61e25e88
y.create.l HWIO_APPS_SMMU_CB6_PMEVTYPER2_APPS_ADDR A:0x61e26e88
y.create.l HWIO_APPS_SMMU_CB7_PMEVTYPER2_APPS_ADDR A:0x61e27e88
y.create.l HWIO_APPS_SMMU_CB8_PMEVTYPER2_APPS_ADDR A:0x61e28e88
y.create.l HWIO_APPS_SMMU_CB9_PMEVTYPER2_APPS_ADDR A:0x61e29e88
y.create.l HWIO_APPS_SMMU_CB10_PMEVTYPER2_APPS_ADDR A:0x61e2ae88
y.create.l HWIO_APPS_SMMU_CB11_PMEVTYPER2_APPS_ADDR A:0x61e2be88
y.create.l HWIO_APPS_SMMU_CB12_PMEVTYPER2_APPS_ADDR A:0x61e2ce88
y.create.l HWIO_APPS_SMMU_CB13_PMEVTYPER2_APPS_ADDR A:0x61e2de88
y.create.l HWIO_APPS_SMMU_CB14_PMEVTYPER2_APPS_ADDR A:0x61e2ee88
y.create.l HWIO_APPS_SMMU_CB15_PMEVTYPER2_APPS_ADDR A:0x61e2fe88
y.create.l HWIO_APPS_SMMU_CB16_PMEVTYPER2_APPS_ADDR A:0x61e30e88
y.create.l HWIO_APPS_SMMU_CB17_PMEVTYPER2_APPS_ADDR A:0x61e31e88
y.create.l HWIO_APPS_SMMU_CB18_PMEVTYPER2_APPS_ADDR A:0x61e32e88
y.create.l HWIO_APPS_SMMU_CB19_PMEVTYPER2_APPS_ADDR A:0x61e33e88
y.create.l HWIO_APPS_SMMU_CB20_PMEVTYPER2_APPS_ADDR A:0x61e34e88
y.create.l HWIO_APPS_SMMU_CB21_PMEVTYPER2_APPS_ADDR A:0x61e35e88
y.create.l HWIO_APPS_SMMU_CB22_PMEVTYPER2_APPS_ADDR A:0x61e36e88
y.create.l HWIO_APPS_SMMU_CB23_PMEVTYPER2_APPS_ADDR A:0x61e37e88
y.create.l HWIO_APPS_SMMU_CB24_PMEVTYPER2_APPS_ADDR A:0x61e38e88
y.create.l HWIO_APPS_SMMU_CB25_PMEVTYPER2_APPS_ADDR A:0x61e39e88
y.create.l HWIO_APPS_SMMU_CB26_PMEVTYPER2_APPS_ADDR A:0x61e3ae88
y.create.l HWIO_APPS_SMMU_CB27_PMEVTYPER2_APPS_ADDR A:0x61e3be88
y.create.l HWIO_APPS_SMMU_CB28_PMEVTYPER2_APPS_ADDR A:0x61e3ce88
y.create.l HWIO_APPS_SMMU_CB29_PMEVTYPER2_APPS_ADDR A:0x61e3de88
y.create.l HWIO_APPS_SMMU_CB30_PMEVTYPER2_APPS_ADDR A:0x61e3ee88
y.create.l HWIO_APPS_SMMU_CB31_PMEVTYPER2_APPS_ADDR A:0x61e3fe88
y.create.l HWIO_APPS_SMMU_CB0_PMEVTYPER3_APPS_ADDR A:0x61e20e8c
y.create.l HWIO_APPS_SMMU_CB1_PMEVTYPER3_APPS_ADDR A:0x61e21e8c
y.create.l HWIO_APPS_SMMU_CB2_PMEVTYPER3_APPS_ADDR A:0x61e22e8c
y.create.l HWIO_APPS_SMMU_CB3_PMEVTYPER3_APPS_ADDR A:0x61e23e8c
y.create.l HWIO_APPS_SMMU_CB4_PMEVTYPER3_APPS_ADDR A:0x61e24e8c
y.create.l HWIO_APPS_SMMU_CB5_PMEVTYPER3_APPS_ADDR A:0x61e25e8c
y.create.l HWIO_APPS_SMMU_CB6_PMEVTYPER3_APPS_ADDR A:0x61e26e8c
y.create.l HWIO_APPS_SMMU_CB7_PMEVTYPER3_APPS_ADDR A:0x61e27e8c
y.create.l HWIO_APPS_SMMU_CB8_PMEVTYPER3_APPS_ADDR A:0x61e28e8c
y.create.l HWIO_APPS_SMMU_CB9_PMEVTYPER3_APPS_ADDR A:0x61e29e8c
y.create.l HWIO_APPS_SMMU_CB10_PMEVTYPER3_APPS_ADDR A:0x61e2ae8c
y.create.l HWIO_APPS_SMMU_CB11_PMEVTYPER3_APPS_ADDR A:0x61e2be8c
y.create.l HWIO_APPS_SMMU_CB12_PMEVTYPER3_APPS_ADDR A:0x61e2ce8c
y.create.l HWIO_APPS_SMMU_CB13_PMEVTYPER3_APPS_ADDR A:0x61e2de8c
y.create.l HWIO_APPS_SMMU_CB14_PMEVTYPER3_APPS_ADDR A:0x61e2ee8c
y.create.l HWIO_APPS_SMMU_CB15_PMEVTYPER3_APPS_ADDR A:0x61e2fe8c
y.create.l HWIO_APPS_SMMU_CB16_PMEVTYPER3_APPS_ADDR A:0x61e30e8c
y.create.l HWIO_APPS_SMMU_CB17_PMEVTYPER3_APPS_ADDR A:0x61e31e8c
y.create.l HWIO_APPS_SMMU_CB18_PMEVTYPER3_APPS_ADDR A:0x61e32e8c
y.create.l HWIO_APPS_SMMU_CB19_PMEVTYPER3_APPS_ADDR A:0x61e33e8c
y.create.l HWIO_APPS_SMMU_CB20_PMEVTYPER3_APPS_ADDR A:0x61e34e8c
y.create.l HWIO_APPS_SMMU_CB21_PMEVTYPER3_APPS_ADDR A:0x61e35e8c
y.create.l HWIO_APPS_SMMU_CB22_PMEVTYPER3_APPS_ADDR A:0x61e36e8c
y.create.l HWIO_APPS_SMMU_CB23_PMEVTYPER3_APPS_ADDR A:0x61e37e8c
y.create.l HWIO_APPS_SMMU_CB24_PMEVTYPER3_APPS_ADDR A:0x61e38e8c
y.create.l HWIO_APPS_SMMU_CB25_PMEVTYPER3_APPS_ADDR A:0x61e39e8c
y.create.l HWIO_APPS_SMMU_CB26_PMEVTYPER3_APPS_ADDR A:0x61e3ae8c
y.create.l HWIO_APPS_SMMU_CB27_PMEVTYPER3_APPS_ADDR A:0x61e3be8c
y.create.l HWIO_APPS_SMMU_CB28_PMEVTYPER3_APPS_ADDR A:0x61e3ce8c
y.create.l HWIO_APPS_SMMU_CB29_PMEVTYPER3_APPS_ADDR A:0x61e3de8c
y.create.l HWIO_APPS_SMMU_CB30_PMEVTYPER3_APPS_ADDR A:0x61e3ee8c
y.create.l HWIO_APPS_SMMU_CB31_PMEVTYPER3_APPS_ADDR A:0x61e3fe8c
y.create.l HWIO_APPS_SMMU_CB0_PMCFGR_APPS_ADDR A:0x61e20f00
y.create.l HWIO_APPS_SMMU_CB1_PMCFGR_APPS_ADDR A:0x61e21f00
y.create.l HWIO_APPS_SMMU_CB2_PMCFGR_APPS_ADDR A:0x61e22f00
y.create.l HWIO_APPS_SMMU_CB3_PMCFGR_APPS_ADDR A:0x61e23f00
y.create.l HWIO_APPS_SMMU_CB4_PMCFGR_APPS_ADDR A:0x61e24f00
y.create.l HWIO_APPS_SMMU_CB5_PMCFGR_APPS_ADDR A:0x61e25f00
y.create.l HWIO_APPS_SMMU_CB6_PMCFGR_APPS_ADDR A:0x61e26f00
y.create.l HWIO_APPS_SMMU_CB7_PMCFGR_APPS_ADDR A:0x61e27f00
y.create.l HWIO_APPS_SMMU_CB8_PMCFGR_APPS_ADDR A:0x61e28f00
y.create.l HWIO_APPS_SMMU_CB9_PMCFGR_APPS_ADDR A:0x61e29f00
y.create.l HWIO_APPS_SMMU_CB10_PMCFGR_APPS_ADDR A:0x61e2af00
y.create.l HWIO_APPS_SMMU_CB11_PMCFGR_APPS_ADDR A:0x61e2bf00
y.create.l HWIO_APPS_SMMU_CB12_PMCFGR_APPS_ADDR A:0x61e2cf00
y.create.l HWIO_APPS_SMMU_CB13_PMCFGR_APPS_ADDR A:0x61e2df00
y.create.l HWIO_APPS_SMMU_CB14_PMCFGR_APPS_ADDR A:0x61e2ef00
y.create.l HWIO_APPS_SMMU_CB15_PMCFGR_APPS_ADDR A:0x61e2ff00
y.create.l HWIO_APPS_SMMU_CB16_PMCFGR_APPS_ADDR A:0x61e30f00
y.create.l HWIO_APPS_SMMU_CB17_PMCFGR_APPS_ADDR A:0x61e31f00
y.create.l HWIO_APPS_SMMU_CB18_PMCFGR_APPS_ADDR A:0x61e32f00
y.create.l HWIO_APPS_SMMU_CB19_PMCFGR_APPS_ADDR A:0x61e33f00
y.create.l HWIO_APPS_SMMU_CB20_PMCFGR_APPS_ADDR A:0x61e34f00
y.create.l HWIO_APPS_SMMU_CB21_PMCFGR_APPS_ADDR A:0x61e35f00
y.create.l HWIO_APPS_SMMU_CB22_PMCFGR_APPS_ADDR A:0x61e36f00
y.create.l HWIO_APPS_SMMU_CB23_PMCFGR_APPS_ADDR A:0x61e37f00
y.create.l HWIO_APPS_SMMU_CB24_PMCFGR_APPS_ADDR A:0x61e38f00
y.create.l HWIO_APPS_SMMU_CB25_PMCFGR_APPS_ADDR A:0x61e39f00
y.create.l HWIO_APPS_SMMU_CB26_PMCFGR_APPS_ADDR A:0x61e3af00
y.create.l HWIO_APPS_SMMU_CB27_PMCFGR_APPS_ADDR A:0x61e3bf00
y.create.l HWIO_APPS_SMMU_CB28_PMCFGR_APPS_ADDR A:0x61e3cf00
y.create.l HWIO_APPS_SMMU_CB29_PMCFGR_APPS_ADDR A:0x61e3df00
y.create.l HWIO_APPS_SMMU_CB30_PMCFGR_APPS_ADDR A:0x61e3ef00
y.create.l HWIO_APPS_SMMU_CB31_PMCFGR_APPS_ADDR A:0x61e3ff00
y.create.l HWIO_APPS_SMMU_CB0_PMCR_APPS_ADDR A:0x61e20f04
y.create.l HWIO_APPS_SMMU_CB1_PMCR_APPS_ADDR A:0x61e21f04
y.create.l HWIO_APPS_SMMU_CB2_PMCR_APPS_ADDR A:0x61e22f04
y.create.l HWIO_APPS_SMMU_CB3_PMCR_APPS_ADDR A:0x61e23f04
y.create.l HWIO_APPS_SMMU_CB4_PMCR_APPS_ADDR A:0x61e24f04
y.create.l HWIO_APPS_SMMU_CB5_PMCR_APPS_ADDR A:0x61e25f04
y.create.l HWIO_APPS_SMMU_CB6_PMCR_APPS_ADDR A:0x61e26f04
y.create.l HWIO_APPS_SMMU_CB7_PMCR_APPS_ADDR A:0x61e27f04
y.create.l HWIO_APPS_SMMU_CB8_PMCR_APPS_ADDR A:0x61e28f04
y.create.l HWIO_APPS_SMMU_CB9_PMCR_APPS_ADDR A:0x61e29f04
y.create.l HWIO_APPS_SMMU_CB10_PMCR_APPS_ADDR A:0x61e2af04
y.create.l HWIO_APPS_SMMU_CB11_PMCR_APPS_ADDR A:0x61e2bf04
y.create.l HWIO_APPS_SMMU_CB12_PMCR_APPS_ADDR A:0x61e2cf04
y.create.l HWIO_APPS_SMMU_CB13_PMCR_APPS_ADDR A:0x61e2df04
y.create.l HWIO_APPS_SMMU_CB14_PMCR_APPS_ADDR A:0x61e2ef04
y.create.l HWIO_APPS_SMMU_CB15_PMCR_APPS_ADDR A:0x61e2ff04
y.create.l HWIO_APPS_SMMU_CB16_PMCR_APPS_ADDR A:0x61e30f04
y.create.l HWIO_APPS_SMMU_CB17_PMCR_APPS_ADDR A:0x61e31f04
y.create.l HWIO_APPS_SMMU_CB18_PMCR_APPS_ADDR A:0x61e32f04
y.create.l HWIO_APPS_SMMU_CB19_PMCR_APPS_ADDR A:0x61e33f04
y.create.l HWIO_APPS_SMMU_CB20_PMCR_APPS_ADDR A:0x61e34f04
y.create.l HWIO_APPS_SMMU_CB21_PMCR_APPS_ADDR A:0x61e35f04
y.create.l HWIO_APPS_SMMU_CB22_PMCR_APPS_ADDR A:0x61e36f04
y.create.l HWIO_APPS_SMMU_CB23_PMCR_APPS_ADDR A:0x61e37f04
y.create.l HWIO_APPS_SMMU_CB24_PMCR_APPS_ADDR A:0x61e38f04
y.create.l HWIO_APPS_SMMU_CB25_PMCR_APPS_ADDR A:0x61e39f04
y.create.l HWIO_APPS_SMMU_CB26_PMCR_APPS_ADDR A:0x61e3af04
y.create.l HWIO_APPS_SMMU_CB27_PMCR_APPS_ADDR A:0x61e3bf04
y.create.l HWIO_APPS_SMMU_CB28_PMCR_APPS_ADDR A:0x61e3cf04
y.create.l HWIO_APPS_SMMU_CB29_PMCR_APPS_ADDR A:0x61e3df04
y.create.l HWIO_APPS_SMMU_CB30_PMCR_APPS_ADDR A:0x61e3ef04
y.create.l HWIO_APPS_SMMU_CB31_PMCR_APPS_ADDR A:0x61e3ff04
y.create.l HWIO_APPS_SMMU_CB0_PMCEID_APPS_ADDR A:0x61e20f20
y.create.l HWIO_APPS_SMMU_CB1_PMCEID_APPS_ADDR A:0x61e21f20
y.create.l HWIO_APPS_SMMU_CB2_PMCEID_APPS_ADDR A:0x61e22f20
y.create.l HWIO_APPS_SMMU_CB3_PMCEID_APPS_ADDR A:0x61e23f20
y.create.l HWIO_APPS_SMMU_CB4_PMCEID_APPS_ADDR A:0x61e24f20
y.create.l HWIO_APPS_SMMU_CB5_PMCEID_APPS_ADDR A:0x61e25f20
y.create.l HWIO_APPS_SMMU_CB6_PMCEID_APPS_ADDR A:0x61e26f20
y.create.l HWIO_APPS_SMMU_CB7_PMCEID_APPS_ADDR A:0x61e27f20
y.create.l HWIO_APPS_SMMU_CB8_PMCEID_APPS_ADDR A:0x61e28f20
y.create.l HWIO_APPS_SMMU_CB9_PMCEID_APPS_ADDR A:0x61e29f20
y.create.l HWIO_APPS_SMMU_CB10_PMCEID_APPS_ADDR A:0x61e2af20
y.create.l HWIO_APPS_SMMU_CB11_PMCEID_APPS_ADDR A:0x61e2bf20
y.create.l HWIO_APPS_SMMU_CB12_PMCEID_APPS_ADDR A:0x61e2cf20
y.create.l HWIO_APPS_SMMU_CB13_PMCEID_APPS_ADDR A:0x61e2df20
y.create.l HWIO_APPS_SMMU_CB14_PMCEID_APPS_ADDR A:0x61e2ef20
y.create.l HWIO_APPS_SMMU_CB15_PMCEID_APPS_ADDR A:0x61e2ff20
y.create.l HWIO_APPS_SMMU_CB16_PMCEID_APPS_ADDR A:0x61e30f20
y.create.l HWIO_APPS_SMMU_CB17_PMCEID_APPS_ADDR A:0x61e31f20
y.create.l HWIO_APPS_SMMU_CB18_PMCEID_APPS_ADDR A:0x61e32f20
y.create.l HWIO_APPS_SMMU_CB19_PMCEID_APPS_ADDR A:0x61e33f20
y.create.l HWIO_APPS_SMMU_CB20_PMCEID_APPS_ADDR A:0x61e34f20
y.create.l HWIO_APPS_SMMU_CB21_PMCEID_APPS_ADDR A:0x61e35f20
y.create.l HWIO_APPS_SMMU_CB22_PMCEID_APPS_ADDR A:0x61e36f20
y.create.l HWIO_APPS_SMMU_CB23_PMCEID_APPS_ADDR A:0x61e37f20
y.create.l HWIO_APPS_SMMU_CB24_PMCEID_APPS_ADDR A:0x61e38f20
y.create.l HWIO_APPS_SMMU_CB25_PMCEID_APPS_ADDR A:0x61e39f20
y.create.l HWIO_APPS_SMMU_CB26_PMCEID_APPS_ADDR A:0x61e3af20
y.create.l HWIO_APPS_SMMU_CB27_PMCEID_APPS_ADDR A:0x61e3bf20
y.create.l HWIO_APPS_SMMU_CB28_PMCEID_APPS_ADDR A:0x61e3cf20
y.create.l HWIO_APPS_SMMU_CB29_PMCEID_APPS_ADDR A:0x61e3df20
y.create.l HWIO_APPS_SMMU_CB30_PMCEID_APPS_ADDR A:0x61e3ef20
y.create.l HWIO_APPS_SMMU_CB31_PMCEID_APPS_ADDR A:0x61e3ff20
y.create.l HWIO_APPS_SMMU_CB0_PMCNTENSE_APPS_ADDR A:0x61e20f40
y.create.l HWIO_APPS_SMMU_CB1_PMCNTENSE_APPS_ADDR A:0x61e21f40
y.create.l HWIO_APPS_SMMU_CB2_PMCNTENSE_APPS_ADDR A:0x61e22f40
y.create.l HWIO_APPS_SMMU_CB3_PMCNTENSE_APPS_ADDR A:0x61e23f40
y.create.l HWIO_APPS_SMMU_CB4_PMCNTENSE_APPS_ADDR A:0x61e24f40
y.create.l HWIO_APPS_SMMU_CB5_PMCNTENSE_APPS_ADDR A:0x61e25f40
y.create.l HWIO_APPS_SMMU_CB6_PMCNTENSE_APPS_ADDR A:0x61e26f40
y.create.l HWIO_APPS_SMMU_CB7_PMCNTENSE_APPS_ADDR A:0x61e27f40
y.create.l HWIO_APPS_SMMU_CB8_PMCNTENSE_APPS_ADDR A:0x61e28f40
y.create.l HWIO_APPS_SMMU_CB9_PMCNTENSE_APPS_ADDR A:0x61e29f40
y.create.l HWIO_APPS_SMMU_CB10_PMCNTENSE_APPS_ADDR A:0x61e2af40
y.create.l HWIO_APPS_SMMU_CB11_PMCNTENSE_APPS_ADDR A:0x61e2bf40
y.create.l HWIO_APPS_SMMU_CB12_PMCNTENSE_APPS_ADDR A:0x61e2cf40
y.create.l HWIO_APPS_SMMU_CB13_PMCNTENSE_APPS_ADDR A:0x61e2df40
y.create.l HWIO_APPS_SMMU_CB14_PMCNTENSE_APPS_ADDR A:0x61e2ef40
y.create.l HWIO_APPS_SMMU_CB15_PMCNTENSE_APPS_ADDR A:0x61e2ff40
y.create.l HWIO_APPS_SMMU_CB16_PMCNTENSE_APPS_ADDR A:0x61e30f40
y.create.l HWIO_APPS_SMMU_CB17_PMCNTENSE_APPS_ADDR A:0x61e31f40
y.create.l HWIO_APPS_SMMU_CB18_PMCNTENSE_APPS_ADDR A:0x61e32f40
y.create.l HWIO_APPS_SMMU_CB19_PMCNTENSE_APPS_ADDR A:0x61e33f40
y.create.l HWIO_APPS_SMMU_CB20_PMCNTENSE_APPS_ADDR A:0x61e34f40
y.create.l HWIO_APPS_SMMU_CB21_PMCNTENSE_APPS_ADDR A:0x61e35f40
y.create.l HWIO_APPS_SMMU_CB22_PMCNTENSE_APPS_ADDR A:0x61e36f40
y.create.l HWIO_APPS_SMMU_CB23_PMCNTENSE_APPS_ADDR A:0x61e37f40
y.create.l HWIO_APPS_SMMU_CB24_PMCNTENSE_APPS_ADDR A:0x61e38f40
y.create.l HWIO_APPS_SMMU_CB25_PMCNTENSE_APPS_ADDR A:0x61e39f40
y.create.l HWIO_APPS_SMMU_CB26_PMCNTENSE_APPS_ADDR A:0x61e3af40
y.create.l HWIO_APPS_SMMU_CB27_PMCNTENSE_APPS_ADDR A:0x61e3bf40
y.create.l HWIO_APPS_SMMU_CB28_PMCNTENSE_APPS_ADDR A:0x61e3cf40
y.create.l HWIO_APPS_SMMU_CB29_PMCNTENSE_APPS_ADDR A:0x61e3df40
y.create.l HWIO_APPS_SMMU_CB30_PMCNTENSE_APPS_ADDR A:0x61e3ef40
y.create.l HWIO_APPS_SMMU_CB31_PMCNTENSE_APPS_ADDR A:0x61e3ff40
y.create.l HWIO_APPS_SMMU_CB0_PMCNTENCLR_APPS_ADDR A:0x61e20f44
y.create.l HWIO_APPS_SMMU_CB1_PMCNTENCLR_APPS_ADDR A:0x61e21f44
y.create.l HWIO_APPS_SMMU_CB2_PMCNTENCLR_APPS_ADDR A:0x61e22f44
y.create.l HWIO_APPS_SMMU_CB3_PMCNTENCLR_APPS_ADDR A:0x61e23f44
y.create.l HWIO_APPS_SMMU_CB4_PMCNTENCLR_APPS_ADDR A:0x61e24f44
y.create.l HWIO_APPS_SMMU_CB5_PMCNTENCLR_APPS_ADDR A:0x61e25f44
y.create.l HWIO_APPS_SMMU_CB6_PMCNTENCLR_APPS_ADDR A:0x61e26f44
y.create.l HWIO_APPS_SMMU_CB7_PMCNTENCLR_APPS_ADDR A:0x61e27f44
y.create.l HWIO_APPS_SMMU_CB8_PMCNTENCLR_APPS_ADDR A:0x61e28f44
y.create.l HWIO_APPS_SMMU_CB9_PMCNTENCLR_APPS_ADDR A:0x61e29f44
y.create.l HWIO_APPS_SMMU_CB10_PMCNTENCLR_APPS_ADDR A:0x61e2af44
y.create.l HWIO_APPS_SMMU_CB11_PMCNTENCLR_APPS_ADDR A:0x61e2bf44
y.create.l HWIO_APPS_SMMU_CB12_PMCNTENCLR_APPS_ADDR A:0x61e2cf44
y.create.l HWIO_APPS_SMMU_CB13_PMCNTENCLR_APPS_ADDR A:0x61e2df44
y.create.l HWIO_APPS_SMMU_CB14_PMCNTENCLR_APPS_ADDR A:0x61e2ef44
y.create.l HWIO_APPS_SMMU_CB15_PMCNTENCLR_APPS_ADDR A:0x61e2ff44
y.create.l HWIO_APPS_SMMU_CB16_PMCNTENCLR_APPS_ADDR A:0x61e30f44
y.create.l HWIO_APPS_SMMU_CB17_PMCNTENCLR_APPS_ADDR A:0x61e31f44
y.create.l HWIO_APPS_SMMU_CB18_PMCNTENCLR_APPS_ADDR A:0x61e32f44
y.create.l HWIO_APPS_SMMU_CB19_PMCNTENCLR_APPS_ADDR A:0x61e33f44
y.create.l HWIO_APPS_SMMU_CB20_PMCNTENCLR_APPS_ADDR A:0x61e34f44
y.create.l HWIO_APPS_SMMU_CB21_PMCNTENCLR_APPS_ADDR A:0x61e35f44
y.create.l HWIO_APPS_SMMU_CB22_PMCNTENCLR_APPS_ADDR A:0x61e36f44
y.create.l HWIO_APPS_SMMU_CB23_PMCNTENCLR_APPS_ADDR A:0x61e37f44
y.create.l HWIO_APPS_SMMU_CB24_PMCNTENCLR_APPS_ADDR A:0x61e38f44
y.create.l HWIO_APPS_SMMU_CB25_PMCNTENCLR_APPS_ADDR A:0x61e39f44
y.create.l HWIO_APPS_SMMU_CB26_PMCNTENCLR_APPS_ADDR A:0x61e3af44
y.create.l HWIO_APPS_SMMU_CB27_PMCNTENCLR_APPS_ADDR A:0x61e3bf44
y.create.l HWIO_APPS_SMMU_CB28_PMCNTENCLR_APPS_ADDR A:0x61e3cf44
y.create.l HWIO_APPS_SMMU_CB29_PMCNTENCLR_APPS_ADDR A:0x61e3df44
y.create.l HWIO_APPS_SMMU_CB30_PMCNTENCLR_APPS_ADDR A:0x61e3ef44
y.create.l HWIO_APPS_SMMU_CB31_PMCNTENCLR_APPS_ADDR A:0x61e3ff44
y.create.l HWIO_APPS_SMMU_CB0_PMCNTENSET_APPS_ADDR A:0x61e20f48
y.create.l HWIO_APPS_SMMU_CB1_PMCNTENSET_APPS_ADDR A:0x61e21f48
y.create.l HWIO_APPS_SMMU_CB2_PMCNTENSET_APPS_ADDR A:0x61e22f48
y.create.l HWIO_APPS_SMMU_CB3_PMCNTENSET_APPS_ADDR A:0x61e23f48
y.create.l HWIO_APPS_SMMU_CB4_PMCNTENSET_APPS_ADDR A:0x61e24f48
y.create.l HWIO_APPS_SMMU_CB5_PMCNTENSET_APPS_ADDR A:0x61e25f48
y.create.l HWIO_APPS_SMMU_CB6_PMCNTENSET_APPS_ADDR A:0x61e26f48
y.create.l HWIO_APPS_SMMU_CB7_PMCNTENSET_APPS_ADDR A:0x61e27f48
y.create.l HWIO_APPS_SMMU_CB8_PMCNTENSET_APPS_ADDR A:0x61e28f48
y.create.l HWIO_APPS_SMMU_CB9_PMCNTENSET_APPS_ADDR A:0x61e29f48
y.create.l HWIO_APPS_SMMU_CB10_PMCNTENSET_APPS_ADDR A:0x61e2af48
y.create.l HWIO_APPS_SMMU_CB11_PMCNTENSET_APPS_ADDR A:0x61e2bf48
y.create.l HWIO_APPS_SMMU_CB12_PMCNTENSET_APPS_ADDR A:0x61e2cf48
y.create.l HWIO_APPS_SMMU_CB13_PMCNTENSET_APPS_ADDR A:0x61e2df48
y.create.l HWIO_APPS_SMMU_CB14_PMCNTENSET_APPS_ADDR A:0x61e2ef48
y.create.l HWIO_APPS_SMMU_CB15_PMCNTENSET_APPS_ADDR A:0x61e2ff48
y.create.l HWIO_APPS_SMMU_CB16_PMCNTENSET_APPS_ADDR A:0x61e30f48
y.create.l HWIO_APPS_SMMU_CB17_PMCNTENSET_APPS_ADDR A:0x61e31f48
y.create.l HWIO_APPS_SMMU_CB18_PMCNTENSET_APPS_ADDR A:0x61e32f48
y.create.l HWIO_APPS_SMMU_CB19_PMCNTENSET_APPS_ADDR A:0x61e33f48
y.create.l HWIO_APPS_SMMU_CB20_PMCNTENSET_APPS_ADDR A:0x61e34f48
y.create.l HWIO_APPS_SMMU_CB21_PMCNTENSET_APPS_ADDR A:0x61e35f48
y.create.l HWIO_APPS_SMMU_CB22_PMCNTENSET_APPS_ADDR A:0x61e36f48
y.create.l HWIO_APPS_SMMU_CB23_PMCNTENSET_APPS_ADDR A:0x61e37f48
y.create.l HWIO_APPS_SMMU_CB24_PMCNTENSET_APPS_ADDR A:0x61e38f48
y.create.l HWIO_APPS_SMMU_CB25_PMCNTENSET_APPS_ADDR A:0x61e39f48
y.create.l HWIO_APPS_SMMU_CB26_PMCNTENSET_APPS_ADDR A:0x61e3af48
y.create.l HWIO_APPS_SMMU_CB27_PMCNTENSET_APPS_ADDR A:0x61e3bf48
y.create.l HWIO_APPS_SMMU_CB28_PMCNTENSET_APPS_ADDR A:0x61e3cf48
y.create.l HWIO_APPS_SMMU_CB29_PMCNTENSET_APPS_ADDR A:0x61e3df48
y.create.l HWIO_APPS_SMMU_CB30_PMCNTENSET_APPS_ADDR A:0x61e3ef48
y.create.l HWIO_APPS_SMMU_CB31_PMCNTENSET_APPS_ADDR A:0x61e3ff48
y.create.l HWIO_APPS_SMMU_CB0_PMINTENCLR_APPS_ADDR A:0x61e20f4c
y.create.l HWIO_APPS_SMMU_CB1_PMINTENCLR_APPS_ADDR A:0x61e21f4c
y.create.l HWIO_APPS_SMMU_CB2_PMINTENCLR_APPS_ADDR A:0x61e22f4c
y.create.l HWIO_APPS_SMMU_CB3_PMINTENCLR_APPS_ADDR A:0x61e23f4c
y.create.l HWIO_APPS_SMMU_CB4_PMINTENCLR_APPS_ADDR A:0x61e24f4c
y.create.l HWIO_APPS_SMMU_CB5_PMINTENCLR_APPS_ADDR A:0x61e25f4c
y.create.l HWIO_APPS_SMMU_CB6_PMINTENCLR_APPS_ADDR A:0x61e26f4c
y.create.l HWIO_APPS_SMMU_CB7_PMINTENCLR_APPS_ADDR A:0x61e27f4c
y.create.l HWIO_APPS_SMMU_CB8_PMINTENCLR_APPS_ADDR A:0x61e28f4c
y.create.l HWIO_APPS_SMMU_CB9_PMINTENCLR_APPS_ADDR A:0x61e29f4c
y.create.l HWIO_APPS_SMMU_CB10_PMINTENCLR_APPS_ADDR A:0x61e2af4c
y.create.l HWIO_APPS_SMMU_CB11_PMINTENCLR_APPS_ADDR A:0x61e2bf4c
y.create.l HWIO_APPS_SMMU_CB12_PMINTENCLR_APPS_ADDR A:0x61e2cf4c
y.create.l HWIO_APPS_SMMU_CB13_PMINTENCLR_APPS_ADDR A:0x61e2df4c
y.create.l HWIO_APPS_SMMU_CB14_PMINTENCLR_APPS_ADDR A:0x61e2ef4c
y.create.l HWIO_APPS_SMMU_CB15_PMINTENCLR_APPS_ADDR A:0x61e2ff4c
y.create.l HWIO_APPS_SMMU_CB16_PMINTENCLR_APPS_ADDR A:0x61e30f4c
y.create.l HWIO_APPS_SMMU_CB17_PMINTENCLR_APPS_ADDR A:0x61e31f4c
y.create.l HWIO_APPS_SMMU_CB18_PMINTENCLR_APPS_ADDR A:0x61e32f4c
y.create.l HWIO_APPS_SMMU_CB19_PMINTENCLR_APPS_ADDR A:0x61e33f4c
y.create.l HWIO_APPS_SMMU_CB20_PMINTENCLR_APPS_ADDR A:0x61e34f4c
y.create.l HWIO_APPS_SMMU_CB21_PMINTENCLR_APPS_ADDR A:0x61e35f4c
y.create.l HWIO_APPS_SMMU_CB22_PMINTENCLR_APPS_ADDR A:0x61e36f4c
y.create.l HWIO_APPS_SMMU_CB23_PMINTENCLR_APPS_ADDR A:0x61e37f4c
y.create.l HWIO_APPS_SMMU_CB24_PMINTENCLR_APPS_ADDR A:0x61e38f4c
y.create.l HWIO_APPS_SMMU_CB25_PMINTENCLR_APPS_ADDR A:0x61e39f4c
y.create.l HWIO_APPS_SMMU_CB26_PMINTENCLR_APPS_ADDR A:0x61e3af4c
y.create.l HWIO_APPS_SMMU_CB27_PMINTENCLR_APPS_ADDR A:0x61e3bf4c
y.create.l HWIO_APPS_SMMU_CB28_PMINTENCLR_APPS_ADDR A:0x61e3cf4c
y.create.l HWIO_APPS_SMMU_CB29_PMINTENCLR_APPS_ADDR A:0x61e3df4c
y.create.l HWIO_APPS_SMMU_CB30_PMINTENCLR_APPS_ADDR A:0x61e3ef4c
y.create.l HWIO_APPS_SMMU_CB31_PMINTENCLR_APPS_ADDR A:0x61e3ff4c
y.create.l HWIO_APPS_SMMU_CB0_PMOVSCLR_APPS_ADDR A:0x61e20f50
y.create.l HWIO_APPS_SMMU_CB1_PMOVSCLR_APPS_ADDR A:0x61e21f50
y.create.l HWIO_APPS_SMMU_CB2_PMOVSCLR_APPS_ADDR A:0x61e22f50
y.create.l HWIO_APPS_SMMU_CB3_PMOVSCLR_APPS_ADDR A:0x61e23f50
y.create.l HWIO_APPS_SMMU_CB4_PMOVSCLR_APPS_ADDR A:0x61e24f50
y.create.l HWIO_APPS_SMMU_CB5_PMOVSCLR_APPS_ADDR A:0x61e25f50
y.create.l HWIO_APPS_SMMU_CB6_PMOVSCLR_APPS_ADDR A:0x61e26f50
y.create.l HWIO_APPS_SMMU_CB7_PMOVSCLR_APPS_ADDR A:0x61e27f50
y.create.l HWIO_APPS_SMMU_CB8_PMOVSCLR_APPS_ADDR A:0x61e28f50
y.create.l HWIO_APPS_SMMU_CB9_PMOVSCLR_APPS_ADDR A:0x61e29f50
y.create.l HWIO_APPS_SMMU_CB10_PMOVSCLR_APPS_ADDR A:0x61e2af50
y.create.l HWIO_APPS_SMMU_CB11_PMOVSCLR_APPS_ADDR A:0x61e2bf50
y.create.l HWIO_APPS_SMMU_CB12_PMOVSCLR_APPS_ADDR A:0x61e2cf50
y.create.l HWIO_APPS_SMMU_CB13_PMOVSCLR_APPS_ADDR A:0x61e2df50
y.create.l HWIO_APPS_SMMU_CB14_PMOVSCLR_APPS_ADDR A:0x61e2ef50
y.create.l HWIO_APPS_SMMU_CB15_PMOVSCLR_APPS_ADDR A:0x61e2ff50
y.create.l HWIO_APPS_SMMU_CB16_PMOVSCLR_APPS_ADDR A:0x61e30f50
y.create.l HWIO_APPS_SMMU_CB17_PMOVSCLR_APPS_ADDR A:0x61e31f50
y.create.l HWIO_APPS_SMMU_CB18_PMOVSCLR_APPS_ADDR A:0x61e32f50
y.create.l HWIO_APPS_SMMU_CB19_PMOVSCLR_APPS_ADDR A:0x61e33f50
y.create.l HWIO_APPS_SMMU_CB20_PMOVSCLR_APPS_ADDR A:0x61e34f50
y.create.l HWIO_APPS_SMMU_CB21_PMOVSCLR_APPS_ADDR A:0x61e35f50
y.create.l HWIO_APPS_SMMU_CB22_PMOVSCLR_APPS_ADDR A:0x61e36f50
y.create.l HWIO_APPS_SMMU_CB23_PMOVSCLR_APPS_ADDR A:0x61e37f50
y.create.l HWIO_APPS_SMMU_CB24_PMOVSCLR_APPS_ADDR A:0x61e38f50
y.create.l HWIO_APPS_SMMU_CB25_PMOVSCLR_APPS_ADDR A:0x61e39f50
y.create.l HWIO_APPS_SMMU_CB26_PMOVSCLR_APPS_ADDR A:0x61e3af50
y.create.l HWIO_APPS_SMMU_CB27_PMOVSCLR_APPS_ADDR A:0x61e3bf50
y.create.l HWIO_APPS_SMMU_CB28_PMOVSCLR_APPS_ADDR A:0x61e3cf50
y.create.l HWIO_APPS_SMMU_CB29_PMOVSCLR_APPS_ADDR A:0x61e3df50
y.create.l HWIO_APPS_SMMU_CB30_PMOVSCLR_APPS_ADDR A:0x61e3ef50
y.create.l HWIO_APPS_SMMU_CB31_PMOVSCLR_APPS_ADDR A:0x61e3ff50
y.create.l HWIO_APPS_SMMU_CB0_PMOVSSET_APPS_ADDR A:0x61e20f58
y.create.l HWIO_APPS_SMMU_CB1_PMOVSSET_APPS_ADDR A:0x61e21f58
y.create.l HWIO_APPS_SMMU_CB2_PMOVSSET_APPS_ADDR A:0x61e22f58
y.create.l HWIO_APPS_SMMU_CB3_PMOVSSET_APPS_ADDR A:0x61e23f58
y.create.l HWIO_APPS_SMMU_CB4_PMOVSSET_APPS_ADDR A:0x61e24f58
y.create.l HWIO_APPS_SMMU_CB5_PMOVSSET_APPS_ADDR A:0x61e25f58
y.create.l HWIO_APPS_SMMU_CB6_PMOVSSET_APPS_ADDR A:0x61e26f58
y.create.l HWIO_APPS_SMMU_CB7_PMOVSSET_APPS_ADDR A:0x61e27f58
y.create.l HWIO_APPS_SMMU_CB8_PMOVSSET_APPS_ADDR A:0x61e28f58
y.create.l HWIO_APPS_SMMU_CB9_PMOVSSET_APPS_ADDR A:0x61e29f58
y.create.l HWIO_APPS_SMMU_CB10_PMOVSSET_APPS_ADDR A:0x61e2af58
y.create.l HWIO_APPS_SMMU_CB11_PMOVSSET_APPS_ADDR A:0x61e2bf58
y.create.l HWIO_APPS_SMMU_CB12_PMOVSSET_APPS_ADDR A:0x61e2cf58
y.create.l HWIO_APPS_SMMU_CB13_PMOVSSET_APPS_ADDR A:0x61e2df58
y.create.l HWIO_APPS_SMMU_CB14_PMOVSSET_APPS_ADDR A:0x61e2ef58
y.create.l HWIO_APPS_SMMU_CB15_PMOVSSET_APPS_ADDR A:0x61e2ff58
y.create.l HWIO_APPS_SMMU_CB16_PMOVSSET_APPS_ADDR A:0x61e30f58
y.create.l HWIO_APPS_SMMU_CB17_PMOVSSET_APPS_ADDR A:0x61e31f58
y.create.l HWIO_APPS_SMMU_CB18_PMOVSSET_APPS_ADDR A:0x61e32f58
y.create.l HWIO_APPS_SMMU_CB19_PMOVSSET_APPS_ADDR A:0x61e33f58
y.create.l HWIO_APPS_SMMU_CB20_PMOVSSET_APPS_ADDR A:0x61e34f58
y.create.l HWIO_APPS_SMMU_CB21_PMOVSSET_APPS_ADDR A:0x61e35f58
y.create.l HWIO_APPS_SMMU_CB22_PMOVSSET_APPS_ADDR A:0x61e36f58
y.create.l HWIO_APPS_SMMU_CB23_PMOVSSET_APPS_ADDR A:0x61e37f58
y.create.l HWIO_APPS_SMMU_CB24_PMOVSSET_APPS_ADDR A:0x61e38f58
y.create.l HWIO_APPS_SMMU_CB25_PMOVSSET_APPS_ADDR A:0x61e39f58
y.create.l HWIO_APPS_SMMU_CB26_PMOVSSET_APPS_ADDR A:0x61e3af58
y.create.l HWIO_APPS_SMMU_CB27_PMOVSSET_APPS_ADDR A:0x61e3bf58
y.create.l HWIO_APPS_SMMU_CB28_PMOVSSET_APPS_ADDR A:0x61e3cf58
y.create.l HWIO_APPS_SMMU_CB29_PMOVSSET_APPS_ADDR A:0x61e3df58
y.create.l HWIO_APPS_SMMU_CB30_PMOVSSET_APPS_ADDR A:0x61e3ef58
y.create.l HWIO_APPS_SMMU_CB31_PMOVSSET_APPS_ADDR A:0x61e3ff58
y.create.l HWIO_APPS_SMMU_CB0_PMAUTHSTATUS_APPS_ADDR A:0x61e20fb8
y.create.l HWIO_APPS_SMMU_CB1_PMAUTHSTATUS_APPS_ADDR A:0x61e21fb8
y.create.l HWIO_APPS_SMMU_CB2_PMAUTHSTATUS_APPS_ADDR A:0x61e22fb8
y.create.l HWIO_APPS_SMMU_CB3_PMAUTHSTATUS_APPS_ADDR A:0x61e23fb8
y.create.l HWIO_APPS_SMMU_CB4_PMAUTHSTATUS_APPS_ADDR A:0x61e24fb8
y.create.l HWIO_APPS_SMMU_CB5_PMAUTHSTATUS_APPS_ADDR A:0x61e25fb8
y.create.l HWIO_APPS_SMMU_CB6_PMAUTHSTATUS_APPS_ADDR A:0x61e26fb8
y.create.l HWIO_APPS_SMMU_CB7_PMAUTHSTATUS_APPS_ADDR A:0x61e27fb8
y.create.l HWIO_APPS_SMMU_CB8_PMAUTHSTATUS_APPS_ADDR A:0x61e28fb8
y.create.l HWIO_APPS_SMMU_CB9_PMAUTHSTATUS_APPS_ADDR A:0x61e29fb8
y.create.l HWIO_APPS_SMMU_CB10_PMAUTHSTATUS_APPS_ADDR A:0x61e2afb8
y.create.l HWIO_APPS_SMMU_CB11_PMAUTHSTATUS_APPS_ADDR A:0x61e2bfb8
y.create.l HWIO_APPS_SMMU_CB12_PMAUTHSTATUS_APPS_ADDR A:0x61e2cfb8
y.create.l HWIO_APPS_SMMU_CB13_PMAUTHSTATUS_APPS_ADDR A:0x61e2dfb8
y.create.l HWIO_APPS_SMMU_CB14_PMAUTHSTATUS_APPS_ADDR A:0x61e2efb8
y.create.l HWIO_APPS_SMMU_CB15_PMAUTHSTATUS_APPS_ADDR A:0x61e2ffb8
y.create.l HWIO_APPS_SMMU_CB16_PMAUTHSTATUS_APPS_ADDR A:0x61e30fb8
y.create.l HWIO_APPS_SMMU_CB17_PMAUTHSTATUS_APPS_ADDR A:0x61e31fb8
y.create.l HWIO_APPS_SMMU_CB18_PMAUTHSTATUS_APPS_ADDR A:0x61e32fb8
y.create.l HWIO_APPS_SMMU_CB19_PMAUTHSTATUS_APPS_ADDR A:0x61e33fb8
y.create.l HWIO_APPS_SMMU_CB20_PMAUTHSTATUS_APPS_ADDR A:0x61e34fb8
y.create.l HWIO_APPS_SMMU_CB21_PMAUTHSTATUS_APPS_ADDR A:0x61e35fb8
y.create.l HWIO_APPS_SMMU_CB22_PMAUTHSTATUS_APPS_ADDR A:0x61e36fb8
y.create.l HWIO_APPS_SMMU_CB23_PMAUTHSTATUS_APPS_ADDR A:0x61e37fb8
y.create.l HWIO_APPS_SMMU_CB24_PMAUTHSTATUS_APPS_ADDR A:0x61e38fb8
y.create.l HWIO_APPS_SMMU_CB25_PMAUTHSTATUS_APPS_ADDR A:0x61e39fb8
y.create.l HWIO_APPS_SMMU_CB26_PMAUTHSTATUS_APPS_ADDR A:0x61e3afb8
y.create.l HWIO_APPS_SMMU_CB27_PMAUTHSTATUS_APPS_ADDR A:0x61e3bfb8
y.create.l HWIO_APPS_SMMU_CB28_PMAUTHSTATUS_APPS_ADDR A:0x61e3cfb8
y.create.l HWIO_APPS_SMMU_CB29_PMAUTHSTATUS_APPS_ADDR A:0x61e3dfb8
y.create.l HWIO_APPS_SMMU_CB30_PMAUTHSTATUS_APPS_ADDR A:0x61e3efb8
y.create.l HWIO_APPS_SMMU_CB31_PMAUTHSTATUS_APPS_ADDR A:0x61e3ffb8
y.create.l HWIO_APPS_SMMU_CR0_APPS_ADDR A:0x61e00000
y.create.l HWIO_APPS_SMMU_ACR_APPS_ADDR A:0x61e00010
y.create.l HWIO_APPS_SMMU_IDR0_APPS_ADDR A:0x61e00020
y.create.l HWIO_APPS_SMMU_IDR1_APPS_ADDR A:0x61e00024
y.create.l HWIO_APPS_SMMU_IDR2_APPS_ADDR A:0x61e00028
y.create.l HWIO_APPS_SMMU_IDR7_APPS_ADDR A:0x61e0003c
y.create.l HWIO_APPS_SMMU_GFAR_LOW_APPS_ADDR A:0x61e00040
y.create.l HWIO_APPS_SMMU_GFAR_HIGH_APPS_ADDR A:0x61e00044
y.create.l HWIO_APPS_SMMU_GFSR_APPS_ADDR A:0x61e00048
y.create.l HWIO_APPS_SMMU_GFSRRESTORE_APPS_ADDR A:0x61e0004c
y.create.l HWIO_APPS_SMMU_GFSYNR0_APPS_ADDR A:0x61e00050
y.create.l HWIO_APPS_SMMU_GFSYNR1_APPS_ADDR A:0x61e00054
y.create.l HWIO_APPS_SMMU_TLBIVMID_2_APPS_ADDR A:0x61e00064
y.create.l HWIO_APPS_SMMU_TLBIALLNSNH_2_APPS_ADDR A:0x61e00068
y.create.l HWIO_APPS_SMMU_TLBIALLH_APPS_ADDR A:0x61e0006c
y.create.l HWIO_APPS_SMMU_TLBGSYNC_APPS_ADDR A:0x61e00070
y.create.l HWIO_APPS_SMMU_TLBGSTATUS_APPS_ADDR A:0x61e00074
y.create.l HWIO_APPS_SMMU_TLBIVAH_LOW_APPS_ADDR A:0x61e00078
y.create.l HWIO_APPS_SMMU_TLBIVALH64_LOW_APPS_ADDR A:0x61e000b0
y.create.l HWIO_APPS_SMMU_TLBIVALH64_HIGH_APPS_ADDR A:0x61e000b4
y.create.l HWIO_APPS_SMMU_TLBIVMIDS1_APPS_ADDR A:0x61e000b8
y.create.l HWIO_APPS_SMMU_TLBIVAH64_LOW_APPS_ADDR A:0x61e000c0
y.create.l HWIO_APPS_SMMU_TLBIVAH64_HIGH_APPS_ADDR A:0x61e000c4
y.create.l HWIO_APPS_SMMU_SMR0_2_APPS_ADDR A:0x61e00800
y.create.l HWIO_APPS_SMMU_SMR1_2_APPS_ADDR A:0x61e00804
y.create.l HWIO_APPS_SMMU_SMR2_2_APPS_ADDR A:0x61e00808
y.create.l HWIO_APPS_SMMU_SMR3_2_APPS_ADDR A:0x61e0080c
y.create.l HWIO_APPS_SMMU_SMR4_2_APPS_ADDR A:0x61e00810
y.create.l HWIO_APPS_SMMU_SMR5_2_APPS_ADDR A:0x61e00814
y.create.l HWIO_APPS_SMMU_SMR6_2_APPS_ADDR A:0x61e00818
y.create.l HWIO_APPS_SMMU_SMR7_2_APPS_ADDR A:0x61e0081c
y.create.l HWIO_APPS_SMMU_SMR8_2_APPS_ADDR A:0x61e00820
y.create.l HWIO_APPS_SMMU_SMR9_2_APPS_ADDR A:0x61e00824
y.create.l HWIO_APPS_SMMU_SMR10_2_APPS_ADDR A:0x61e00828
y.create.l HWIO_APPS_SMMU_SMR11_2_APPS_ADDR A:0x61e0082c
y.create.l HWIO_APPS_SMMU_SMR12_2_APPS_ADDR A:0x61e00830
y.create.l HWIO_APPS_SMMU_SMR13_2_APPS_ADDR A:0x61e00834
y.create.l HWIO_APPS_SMMU_SMR14_2_APPS_ADDR A:0x61e00838
y.create.l HWIO_APPS_SMMU_SMR15_2_APPS_ADDR A:0x61e0083c
y.create.l HWIO_APPS_SMMU_SMR16_2_APPS_ADDR A:0x61e00840
y.create.l HWIO_APPS_SMMU_SMR17_2_APPS_ADDR A:0x61e00844
y.create.l HWIO_APPS_SMMU_SMR18_2_APPS_ADDR A:0x61e00848
y.create.l HWIO_APPS_SMMU_SMR19_2_APPS_ADDR A:0x61e0084c
y.create.l HWIO_APPS_SMMU_SMR20_2_APPS_ADDR A:0x61e00850
y.create.l HWIO_APPS_SMMU_SMR21_2_APPS_ADDR A:0x61e00854
y.create.l HWIO_APPS_SMMU_SMR22_2_APPS_ADDR A:0x61e00858
y.create.l HWIO_APPS_SMMU_SMR23_2_APPS_ADDR A:0x61e0085c
y.create.l HWIO_APPS_SMMU_SMR24_2_APPS_ADDR A:0x61e00860
y.create.l HWIO_APPS_SMMU_SMR25_2_APPS_ADDR A:0x61e00864
y.create.l HWIO_APPS_SMMU_SMR26_2_APPS_ADDR A:0x61e00868
y.create.l HWIO_APPS_SMMU_SMR27_2_APPS_ADDR A:0x61e0086c
y.create.l HWIO_APPS_SMMU_SMR28_2_APPS_ADDR A:0x61e00870
y.create.l HWIO_APPS_SMMU_SMR29_2_APPS_ADDR A:0x61e00874
y.create.l HWIO_APPS_SMMU_SMR30_2_APPS_ADDR A:0x61e00878
y.create.l HWIO_APPS_SMMU_SMR31_2_APPS_ADDR A:0x61e0087c
y.create.l HWIO_APPS_SMMU_SMR32_2_APPS_ADDR A:0x61e00880
y.create.l HWIO_APPS_SMMU_SMR33_2_APPS_ADDR A:0x61e00884
y.create.l HWIO_APPS_SMMU_SMR34_2_APPS_ADDR A:0x61e00888
y.create.l HWIO_APPS_SMMU_SMR35_2_APPS_ADDR A:0x61e0088c
y.create.l HWIO_APPS_SMMU_SMR36_2_APPS_ADDR A:0x61e00890
y.create.l HWIO_APPS_SMMU_SMR37_2_APPS_ADDR A:0x61e00894
y.create.l HWIO_APPS_SMMU_SMR38_2_APPS_ADDR A:0x61e00898
y.create.l HWIO_APPS_SMMU_SMR39_2_APPS_ADDR A:0x61e0089c
y.create.l HWIO_APPS_SMMU_SMR40_2_APPS_ADDR A:0x61e008a0
y.create.l HWIO_APPS_SMMU_SMR41_2_APPS_ADDR A:0x61e008a4
y.create.l HWIO_APPS_SMMU_SMR42_2_APPS_ADDR A:0x61e008a8
y.create.l HWIO_APPS_SMMU_SMR43_2_APPS_ADDR A:0x61e008ac
y.create.l HWIO_APPS_SMMU_SMR44_2_APPS_ADDR A:0x61e008b0
y.create.l HWIO_APPS_SMMU_SMR45_2_APPS_ADDR A:0x61e008b4
y.create.l HWIO_APPS_SMMU_SMR46_2_APPS_ADDR A:0x61e008b8
y.create.l HWIO_APPS_SMMU_SMR47_2_APPS_ADDR A:0x61e008bc
y.create.l HWIO_APPS_SMMU_SMR48_2_APPS_ADDR A:0x61e008c0
y.create.l HWIO_APPS_SMMU_SMR49_2_APPS_ADDR A:0x61e008c4
y.create.l HWIO_APPS_SMMU_SMR50_2_APPS_ADDR A:0x61e008c8
y.create.l HWIO_APPS_SMMU_SMR51_2_APPS_ADDR A:0x61e008cc
y.create.l HWIO_APPS_SMMU_SMR52_2_APPS_ADDR A:0x61e008d0
y.create.l HWIO_APPS_SMMU_SMR53_2_APPS_ADDR A:0x61e008d4
y.create.l HWIO_APPS_SMMU_SMR54_2_APPS_ADDR A:0x61e008d8
y.create.l HWIO_APPS_SMMU_SMR55_2_APPS_ADDR A:0x61e008dc
y.create.l HWIO_APPS_SMMU_SMR56_2_APPS_ADDR A:0x61e008e0
y.create.l HWIO_APPS_SMMU_SMR57_2_APPS_ADDR A:0x61e008e4
y.create.l HWIO_APPS_SMMU_SMR58_2_APPS_ADDR A:0x61e008e8
y.create.l HWIO_APPS_SMMU_SMR59_2_APPS_ADDR A:0x61e008ec
y.create.l HWIO_APPS_SMMU_SMR60_2_APPS_ADDR A:0x61e008f0
y.create.l HWIO_APPS_SMMU_SMR61_2_APPS_ADDR A:0x61e008f4
y.create.l HWIO_APPS_SMMU_SMR62_2_APPS_ADDR A:0x61e008f8
y.create.l HWIO_APPS_SMMU_SMR63_2_APPS_ADDR A:0x61e008fc
y.create.l HWIO_APPS_SMMU_SMR64_2_APPS_ADDR A:0x61e00900
y.create.l HWIO_APPS_SMMU_SMR65_2_APPS_ADDR A:0x61e00904
y.create.l HWIO_APPS_SMMU_SMR66_2_APPS_ADDR A:0x61e00908
y.create.l HWIO_APPS_SMMU_SMR67_2_APPS_ADDR A:0x61e0090c
y.create.l HWIO_APPS_SMMU_SMR68_2_APPS_ADDR A:0x61e00910
y.create.l HWIO_APPS_SMMU_SMR69_2_APPS_ADDR A:0x61e00914
y.create.l HWIO_APPS_SMMU_SMR70_2_APPS_ADDR A:0x61e00918
y.create.l HWIO_APPS_SMMU_SMR71_2_APPS_ADDR A:0x61e0091c
y.create.l HWIO_APPS_SMMU_SMR72_2_APPS_ADDR A:0x61e00920
y.create.l HWIO_APPS_SMMU_SMR73_2_APPS_ADDR A:0x61e00924
y.create.l HWIO_APPS_SMMU_SMR74_2_APPS_ADDR A:0x61e00928
y.create.l HWIO_APPS_SMMU_SMR75_2_APPS_ADDR A:0x61e0092c
y.create.l HWIO_APPS_SMMU_SMR76_2_APPS_ADDR A:0x61e00930
y.create.l HWIO_APPS_SMMU_SMR77_2_APPS_ADDR A:0x61e00934
y.create.l HWIO_APPS_SMMU_SMR78_2_APPS_ADDR A:0x61e00938
y.create.l HWIO_APPS_SMMU_SMR79_2_APPS_ADDR A:0x61e0093c
y.create.l HWIO_APPS_SMMU_SMR80_2_APPS_ADDR A:0x61e00940
y.create.l HWIO_APPS_SMMU_SMR81_2_APPS_ADDR A:0x61e00944
y.create.l HWIO_APPS_SMMU_SMR82_2_APPS_ADDR A:0x61e00948
y.create.l HWIO_APPS_SMMU_SMR83_2_APPS_ADDR A:0x61e0094c
y.create.l HWIO_APPS_SMMU_SMR84_2_APPS_ADDR A:0x61e00950
y.create.l HWIO_APPS_SMMU_SMR85_2_APPS_ADDR A:0x61e00954
y.create.l HWIO_APPS_SMMU_SMR86_2_APPS_ADDR A:0x61e00958
y.create.l HWIO_APPS_SMMU_SMR87_2_APPS_ADDR A:0x61e0095c
y.create.l HWIO_APPS_SMMU_SMR88_2_APPS_ADDR A:0x61e00960
y.create.l HWIO_APPS_SMMU_SMR89_2_APPS_ADDR A:0x61e00964
y.create.l HWIO_APPS_SMMU_SMR90_2_APPS_ADDR A:0x61e00968
y.create.l HWIO_APPS_SMMU_SMR91_2_APPS_ADDR A:0x61e0096c
y.create.l HWIO_APPS_SMMU_SMR92_2_APPS_ADDR A:0x61e00970
y.create.l HWIO_APPS_SMMU_SMR93_2_APPS_ADDR A:0x61e00974
y.create.l HWIO_APPS_SMMU_SMR94_2_APPS_ADDR A:0x61e00978
y.create.l HWIO_APPS_SMMU_SMR95_2_APPS_ADDR A:0x61e0097c
y.create.l HWIO_APPS_SMMU_SMR96_2_APPS_ADDR A:0x61e00980
y.create.l HWIO_APPS_SMMU_SMR97_2_APPS_ADDR A:0x61e00984
y.create.l HWIO_APPS_SMMU_SMR98_2_APPS_ADDR A:0x61e00988
y.create.l HWIO_APPS_SMMU_SMR99_2_APPS_ADDR A:0x61e0098c
y.create.l HWIO_APPS_SMMU_SMR100_2_APPS_ADDR A:0x61e00990
y.create.l HWIO_APPS_SMMU_SMR101_2_APPS_ADDR A:0x61e00994
y.create.l HWIO_APPS_SMMU_SMR102_2_APPS_ADDR A:0x61e00998
y.create.l HWIO_APPS_SMMU_SMR103_2_APPS_ADDR A:0x61e0099c
y.create.l HWIO_APPS_SMMU_SMR104_2_APPS_ADDR A:0x61e009a0
y.create.l HWIO_APPS_SMMU_SMR105_2_APPS_ADDR A:0x61e009a4
y.create.l HWIO_APPS_SMMU_SMR106_2_APPS_ADDR A:0x61e009a8
y.create.l HWIO_APPS_SMMU_SMR107_2_APPS_ADDR A:0x61e009ac
y.create.l HWIO_APPS_SMMU_SMR108_2_APPS_ADDR A:0x61e009b0
y.create.l HWIO_APPS_SMMU_SMR109_2_APPS_ADDR A:0x61e009b4
y.create.l HWIO_APPS_SMMU_SMR110_2_APPS_ADDR A:0x61e009b8
y.create.l HWIO_APPS_SMMU_SMR111_2_APPS_ADDR A:0x61e009bc
y.create.l HWIO_APPS_SMMU_SMR112_2_APPS_ADDR A:0x61e009c0
y.create.l HWIO_APPS_SMMU_SMR113_2_APPS_ADDR A:0x61e009c4
y.create.l HWIO_APPS_SMMU_SMR114_2_APPS_ADDR A:0x61e009c8
y.create.l HWIO_APPS_SMMU_SMR115_2_APPS_ADDR A:0x61e009cc
y.create.l HWIO_APPS_SMMU_SMR116_2_APPS_ADDR A:0x61e009d0
y.create.l HWIO_APPS_SMMU_SMR117_2_APPS_ADDR A:0x61e009d4
y.create.l HWIO_APPS_SMMU_SMR118_2_APPS_ADDR A:0x61e009d8
y.create.l HWIO_APPS_SMMU_SMR119_2_APPS_ADDR A:0x61e009dc
y.create.l HWIO_APPS_SMMU_SMR120_2_APPS_ADDR A:0x61e009e0
y.create.l HWIO_APPS_SMMU_SMR121_2_APPS_ADDR A:0x61e009e4
y.create.l HWIO_APPS_SMMU_SMR122_2_APPS_ADDR A:0x61e009e8
y.create.l HWIO_APPS_SMMU_SMR123_2_APPS_ADDR A:0x61e009ec
y.create.l HWIO_APPS_SMMU_SMR124_2_APPS_ADDR A:0x61e009f0
y.create.l HWIO_APPS_SMMU_SMR125_2_APPS_ADDR A:0x61e009f4
y.create.l HWIO_APPS_SMMU_SMR126_2_APPS_ADDR A:0x61e009f8
y.create.l HWIO_APPS_SMMU_SMR127_2_APPS_ADDR A:0x61e009fc
y.create.l HWIO_APPS_SMMU_S2CR0_2_APPS_ADDR A:0x61e00c00
y.create.l HWIO_APPS_SMMU_S2CR1_2_APPS_ADDR A:0x61e00c04
y.create.l HWIO_APPS_SMMU_S2CR2_2_APPS_ADDR A:0x61e00c08
y.create.l HWIO_APPS_SMMU_S2CR3_2_APPS_ADDR A:0x61e00c0c
y.create.l HWIO_APPS_SMMU_S2CR4_2_APPS_ADDR A:0x61e00c10
y.create.l HWIO_APPS_SMMU_S2CR5_2_APPS_ADDR A:0x61e00c14
y.create.l HWIO_APPS_SMMU_S2CR6_2_APPS_ADDR A:0x61e00c18
y.create.l HWIO_APPS_SMMU_S2CR7_2_APPS_ADDR A:0x61e00c1c
y.create.l HWIO_APPS_SMMU_S2CR8_2_APPS_ADDR A:0x61e00c20
y.create.l HWIO_APPS_SMMU_S2CR9_2_APPS_ADDR A:0x61e00c24
y.create.l HWIO_APPS_SMMU_S2CR10_2_APPS_ADDR A:0x61e00c28
y.create.l HWIO_APPS_SMMU_S2CR11_2_APPS_ADDR A:0x61e00c2c
y.create.l HWIO_APPS_SMMU_S2CR12_2_APPS_ADDR A:0x61e00c30
y.create.l HWIO_APPS_SMMU_S2CR13_2_APPS_ADDR A:0x61e00c34
y.create.l HWIO_APPS_SMMU_S2CR14_2_APPS_ADDR A:0x61e00c38
y.create.l HWIO_APPS_SMMU_S2CR15_2_APPS_ADDR A:0x61e00c3c
y.create.l HWIO_APPS_SMMU_S2CR16_2_APPS_ADDR A:0x61e00c40
y.create.l HWIO_APPS_SMMU_S2CR17_2_APPS_ADDR A:0x61e00c44
y.create.l HWIO_APPS_SMMU_S2CR18_2_APPS_ADDR A:0x61e00c48
y.create.l HWIO_APPS_SMMU_S2CR19_2_APPS_ADDR A:0x61e00c4c
y.create.l HWIO_APPS_SMMU_S2CR20_2_APPS_ADDR A:0x61e00c50
y.create.l HWIO_APPS_SMMU_S2CR21_2_APPS_ADDR A:0x61e00c54
y.create.l HWIO_APPS_SMMU_S2CR22_2_APPS_ADDR A:0x61e00c58
y.create.l HWIO_APPS_SMMU_S2CR23_2_APPS_ADDR A:0x61e00c5c
y.create.l HWIO_APPS_SMMU_S2CR24_2_APPS_ADDR A:0x61e00c60
y.create.l HWIO_APPS_SMMU_S2CR25_2_APPS_ADDR A:0x61e00c64
y.create.l HWIO_APPS_SMMU_S2CR26_2_APPS_ADDR A:0x61e00c68
y.create.l HWIO_APPS_SMMU_S2CR27_2_APPS_ADDR A:0x61e00c6c
y.create.l HWIO_APPS_SMMU_S2CR28_2_APPS_ADDR A:0x61e00c70
y.create.l HWIO_APPS_SMMU_S2CR29_2_APPS_ADDR A:0x61e00c74
y.create.l HWIO_APPS_SMMU_S2CR30_2_APPS_ADDR A:0x61e00c78
y.create.l HWIO_APPS_SMMU_S2CR31_2_APPS_ADDR A:0x61e00c7c
y.create.l HWIO_APPS_SMMU_S2CR32_2_APPS_ADDR A:0x61e00c80
y.create.l HWIO_APPS_SMMU_S2CR33_2_APPS_ADDR A:0x61e00c84
y.create.l HWIO_APPS_SMMU_S2CR34_2_APPS_ADDR A:0x61e00c88
y.create.l HWIO_APPS_SMMU_S2CR35_2_APPS_ADDR A:0x61e00c8c
y.create.l HWIO_APPS_SMMU_S2CR36_2_APPS_ADDR A:0x61e00c90
y.create.l HWIO_APPS_SMMU_S2CR37_2_APPS_ADDR A:0x61e00c94
y.create.l HWIO_APPS_SMMU_S2CR38_2_APPS_ADDR A:0x61e00c98
y.create.l HWIO_APPS_SMMU_S2CR39_2_APPS_ADDR A:0x61e00c9c
y.create.l HWIO_APPS_SMMU_S2CR40_2_APPS_ADDR A:0x61e00ca0
y.create.l HWIO_APPS_SMMU_S2CR41_2_APPS_ADDR A:0x61e00ca4
y.create.l HWIO_APPS_SMMU_S2CR42_2_APPS_ADDR A:0x61e00ca8
y.create.l HWIO_APPS_SMMU_S2CR43_2_APPS_ADDR A:0x61e00cac
y.create.l HWIO_APPS_SMMU_S2CR44_2_APPS_ADDR A:0x61e00cb0
y.create.l HWIO_APPS_SMMU_S2CR45_2_APPS_ADDR A:0x61e00cb4
y.create.l HWIO_APPS_SMMU_S2CR46_2_APPS_ADDR A:0x61e00cb8
y.create.l HWIO_APPS_SMMU_S2CR47_2_APPS_ADDR A:0x61e00cbc
y.create.l HWIO_APPS_SMMU_S2CR48_2_APPS_ADDR A:0x61e00cc0
y.create.l HWIO_APPS_SMMU_S2CR49_2_APPS_ADDR A:0x61e00cc4
y.create.l HWIO_APPS_SMMU_S2CR50_2_APPS_ADDR A:0x61e00cc8
y.create.l HWIO_APPS_SMMU_S2CR51_2_APPS_ADDR A:0x61e00ccc
y.create.l HWIO_APPS_SMMU_S2CR52_2_APPS_ADDR A:0x61e00cd0
y.create.l HWIO_APPS_SMMU_S2CR53_2_APPS_ADDR A:0x61e00cd4
y.create.l HWIO_APPS_SMMU_S2CR54_2_APPS_ADDR A:0x61e00cd8
y.create.l HWIO_APPS_SMMU_S2CR55_2_APPS_ADDR A:0x61e00cdc
y.create.l HWIO_APPS_SMMU_S2CR56_2_APPS_ADDR A:0x61e00ce0
y.create.l HWIO_APPS_SMMU_S2CR57_2_APPS_ADDR A:0x61e00ce4
y.create.l HWIO_APPS_SMMU_S2CR58_2_APPS_ADDR A:0x61e00ce8
y.create.l HWIO_APPS_SMMU_S2CR59_2_APPS_ADDR A:0x61e00cec
y.create.l HWIO_APPS_SMMU_S2CR60_2_APPS_ADDR A:0x61e00cf0
y.create.l HWIO_APPS_SMMU_S2CR61_2_APPS_ADDR A:0x61e00cf4
y.create.l HWIO_APPS_SMMU_S2CR62_2_APPS_ADDR A:0x61e00cf8
y.create.l HWIO_APPS_SMMU_S2CR63_2_APPS_ADDR A:0x61e00cfc
y.create.l HWIO_APPS_SMMU_S2CR64_2_APPS_ADDR A:0x61e00d00
y.create.l HWIO_APPS_SMMU_S2CR65_2_APPS_ADDR A:0x61e00d04
y.create.l HWIO_APPS_SMMU_S2CR66_2_APPS_ADDR A:0x61e00d08
y.create.l HWIO_APPS_SMMU_S2CR67_2_APPS_ADDR A:0x61e00d0c
y.create.l HWIO_APPS_SMMU_S2CR68_2_APPS_ADDR A:0x61e00d10
y.create.l HWIO_APPS_SMMU_S2CR69_2_APPS_ADDR A:0x61e00d14
y.create.l HWIO_APPS_SMMU_S2CR70_2_APPS_ADDR A:0x61e00d18
y.create.l HWIO_APPS_SMMU_S2CR71_2_APPS_ADDR A:0x61e00d1c
y.create.l HWIO_APPS_SMMU_S2CR72_2_APPS_ADDR A:0x61e00d20
y.create.l HWIO_APPS_SMMU_S2CR73_2_APPS_ADDR A:0x61e00d24
y.create.l HWIO_APPS_SMMU_S2CR74_2_APPS_ADDR A:0x61e00d28
y.create.l HWIO_APPS_SMMU_S2CR75_2_APPS_ADDR A:0x61e00d2c
y.create.l HWIO_APPS_SMMU_S2CR76_2_APPS_ADDR A:0x61e00d30
y.create.l HWIO_APPS_SMMU_S2CR77_2_APPS_ADDR A:0x61e00d34
y.create.l HWIO_APPS_SMMU_S2CR78_2_APPS_ADDR A:0x61e00d38
y.create.l HWIO_APPS_SMMU_S2CR79_2_APPS_ADDR A:0x61e00d3c
y.create.l HWIO_APPS_SMMU_S2CR80_2_APPS_ADDR A:0x61e00d40
y.create.l HWIO_APPS_SMMU_S2CR81_2_APPS_ADDR A:0x61e00d44
y.create.l HWIO_APPS_SMMU_S2CR82_2_APPS_ADDR A:0x61e00d48
y.create.l HWIO_APPS_SMMU_S2CR83_2_APPS_ADDR A:0x61e00d4c
y.create.l HWIO_APPS_SMMU_S2CR84_2_APPS_ADDR A:0x61e00d50
y.create.l HWIO_APPS_SMMU_S2CR85_2_APPS_ADDR A:0x61e00d54
y.create.l HWIO_APPS_SMMU_S2CR86_2_APPS_ADDR A:0x61e00d58
y.create.l HWIO_APPS_SMMU_S2CR87_2_APPS_ADDR A:0x61e00d5c
y.create.l HWIO_APPS_SMMU_S2CR88_2_APPS_ADDR A:0x61e00d60
y.create.l HWIO_APPS_SMMU_S2CR89_2_APPS_ADDR A:0x61e00d64
y.create.l HWIO_APPS_SMMU_S2CR90_2_APPS_ADDR A:0x61e00d68
y.create.l HWIO_APPS_SMMU_S2CR91_2_APPS_ADDR A:0x61e00d6c
y.create.l HWIO_APPS_SMMU_S2CR92_2_APPS_ADDR A:0x61e00d70
y.create.l HWIO_APPS_SMMU_S2CR93_2_APPS_ADDR A:0x61e00d74
y.create.l HWIO_APPS_SMMU_S2CR94_2_APPS_ADDR A:0x61e00d78
y.create.l HWIO_APPS_SMMU_S2CR95_2_APPS_ADDR A:0x61e00d7c
y.create.l HWIO_APPS_SMMU_S2CR96_2_APPS_ADDR A:0x61e00d80
y.create.l HWIO_APPS_SMMU_S2CR97_2_APPS_ADDR A:0x61e00d84
y.create.l HWIO_APPS_SMMU_S2CR98_2_APPS_ADDR A:0x61e00d88
y.create.l HWIO_APPS_SMMU_S2CR99_2_APPS_ADDR A:0x61e00d8c
y.create.l HWIO_APPS_SMMU_S2CR100_2_APPS_ADDR A:0x61e00d90
y.create.l HWIO_APPS_SMMU_S2CR101_2_APPS_ADDR A:0x61e00d94
y.create.l HWIO_APPS_SMMU_S2CR102_2_APPS_ADDR A:0x61e00d98
y.create.l HWIO_APPS_SMMU_S2CR103_2_APPS_ADDR A:0x61e00d9c
y.create.l HWIO_APPS_SMMU_S2CR104_2_APPS_ADDR A:0x61e00da0
y.create.l HWIO_APPS_SMMU_S2CR105_2_APPS_ADDR A:0x61e00da4
y.create.l HWIO_APPS_SMMU_S2CR106_2_APPS_ADDR A:0x61e00da8
y.create.l HWIO_APPS_SMMU_S2CR107_2_APPS_ADDR A:0x61e00dac
y.create.l HWIO_APPS_SMMU_S2CR108_2_APPS_ADDR A:0x61e00db0
y.create.l HWIO_APPS_SMMU_S2CR109_2_APPS_ADDR A:0x61e00db4
y.create.l HWIO_APPS_SMMU_S2CR110_2_APPS_ADDR A:0x61e00db8
y.create.l HWIO_APPS_SMMU_S2CR111_2_APPS_ADDR A:0x61e00dbc
y.create.l HWIO_APPS_SMMU_S2CR112_2_APPS_ADDR A:0x61e00dc0
y.create.l HWIO_APPS_SMMU_S2CR113_2_APPS_ADDR A:0x61e00dc4
y.create.l HWIO_APPS_SMMU_S2CR114_2_APPS_ADDR A:0x61e00dc8
y.create.l HWIO_APPS_SMMU_S2CR115_2_APPS_ADDR A:0x61e00dcc
y.create.l HWIO_APPS_SMMU_S2CR116_2_APPS_ADDR A:0x61e00dd0
y.create.l HWIO_APPS_SMMU_S2CR117_2_APPS_ADDR A:0x61e00dd4
y.create.l HWIO_APPS_SMMU_S2CR118_2_APPS_ADDR A:0x61e00dd8
y.create.l HWIO_APPS_SMMU_S2CR119_2_APPS_ADDR A:0x61e00ddc
y.create.l HWIO_APPS_SMMU_S2CR120_2_APPS_ADDR A:0x61e00de0
y.create.l HWIO_APPS_SMMU_S2CR121_2_APPS_ADDR A:0x61e00de4
y.create.l HWIO_APPS_SMMU_S2CR122_2_APPS_ADDR A:0x61e00de8
y.create.l HWIO_APPS_SMMU_S2CR123_2_APPS_ADDR A:0x61e00dec
y.create.l HWIO_APPS_SMMU_S2CR124_2_APPS_ADDR A:0x61e00df0
y.create.l HWIO_APPS_SMMU_S2CR125_2_APPS_ADDR A:0x61e00df4
y.create.l HWIO_APPS_SMMU_S2CR126_2_APPS_ADDR A:0x61e00df8
y.create.l HWIO_APPS_SMMU_S2CR127_2_APPS_ADDR A:0x61e00dfc
y.create.l HWIO_APPS_SMMU_PIDR0_2_APPS_ADDR A:0x61e00fe0
y.create.l HWIO_APPS_SMMU_PIDR1_2_APPS_ADDR A:0x61e00fe4
y.create.l HWIO_APPS_SMMU_PIDR2_2_APPS_ADDR A:0x61e00fe8
y.create.l HWIO_APPS_SMMU_PIDR3_2_APPS_ADDR A:0x61e00fec
y.create.l HWIO_APPS_SMMU_PIDR4_2_APPS_ADDR A:0x61e00fd0
y.create.l HWIO_APPS_SMMU_PIDR5_2_APPS_ADDR A:0x61e00fd4
y.create.l HWIO_APPS_SMMU_PIDR6_2_APPS_ADDR A:0x61e00fd8
y.create.l HWIO_APPS_SMMU_PIDR7_2_APPS_ADDR A:0x61e00fdc
y.create.l HWIO_APPS_SMMU_CIDR0_2_APPS_ADDR A:0x61e00ff0
y.create.l HWIO_APPS_SMMU_CIDR1_2_APPS_ADDR A:0x61e00ff4
y.create.l HWIO_APPS_SMMU_CIDR2_2_APPS_ADDR A:0x61e00ff8
y.create.l HWIO_APPS_SMMU_CIDR3_2_APPS_ADDR A:0x61e00ffc
y.create.l HWIO_APPS_SMMU_CBAR0_2_APPS_ADDR A:0x61e01000
y.create.l HWIO_APPS_SMMU_CBFRSYNRA0_2_APPS_ADDR A:0x61e01400
y.create.l HWIO_APPS_SMMU_CBA2R0_2_APPS_ADDR A:0x61e01800
y.create.l HWIO_APPS_SMMU_CBAR1_2_APPS_ADDR A:0x61e01004
y.create.l HWIO_APPS_SMMU_CBFRSYNRA1_2_APPS_ADDR A:0x61e01404
y.create.l HWIO_APPS_SMMU_CBA2R1_2_APPS_ADDR A:0x61e01804
y.create.l HWIO_APPS_SMMU_CBAR2_2_APPS_ADDR A:0x61e01008
y.create.l HWIO_APPS_SMMU_CBFRSYNRA2_2_APPS_ADDR A:0x61e01408
y.create.l HWIO_APPS_SMMU_CBA2R2_2_APPS_ADDR A:0x61e01808
y.create.l HWIO_APPS_SMMU_CBAR3_2_APPS_ADDR A:0x61e0100c
y.create.l HWIO_APPS_SMMU_CBFRSYNRA3_2_APPS_ADDR A:0x61e0140c
y.create.l HWIO_APPS_SMMU_CBA2R3_2_APPS_ADDR A:0x61e0180c
y.create.l HWIO_APPS_SMMU_CBAR4_2_APPS_ADDR A:0x61e01010
y.create.l HWIO_APPS_SMMU_CBFRSYNRA4_2_APPS_ADDR A:0x61e01410
y.create.l HWIO_APPS_SMMU_CBA2R4_2_APPS_ADDR A:0x61e01810
y.create.l HWIO_APPS_SMMU_CBAR5_2_APPS_ADDR A:0x61e01014
y.create.l HWIO_APPS_SMMU_CBFRSYNRA5_2_APPS_ADDR A:0x61e01414
y.create.l HWIO_APPS_SMMU_CBA2R5_2_APPS_ADDR A:0x61e01814
y.create.l HWIO_APPS_SMMU_CBAR6_2_APPS_ADDR A:0x61e01018
y.create.l HWIO_APPS_SMMU_CBFRSYNRA6_2_APPS_ADDR A:0x61e01418
y.create.l HWIO_APPS_SMMU_CBA2R6_2_APPS_ADDR A:0x61e01818
y.create.l HWIO_APPS_SMMU_CBAR7_2_APPS_ADDR A:0x61e0101c
y.create.l HWIO_APPS_SMMU_CBFRSYNRA7_2_APPS_ADDR A:0x61e0141c
y.create.l HWIO_APPS_SMMU_CBA2R7_2_APPS_ADDR A:0x61e0181c
y.create.l HWIO_APPS_SMMU_CBAR8_2_APPS_ADDR A:0x61e01020
y.create.l HWIO_APPS_SMMU_CBFRSYNRA8_2_APPS_ADDR A:0x61e01420
y.create.l HWIO_APPS_SMMU_CBA2R8_2_APPS_ADDR A:0x61e01820
y.create.l HWIO_APPS_SMMU_CBAR9_2_APPS_ADDR A:0x61e01024
y.create.l HWIO_APPS_SMMU_CBFRSYNRA9_2_APPS_ADDR A:0x61e01424
y.create.l HWIO_APPS_SMMU_CBA2R9_2_APPS_ADDR A:0x61e01824
y.create.l HWIO_APPS_SMMU_CBAR10_2_APPS_ADDR A:0x61e01028
y.create.l HWIO_APPS_SMMU_CBFRSYNRA10_2_APPS_ADDR A:0x61e01428
y.create.l HWIO_APPS_SMMU_CBA2R10_2_APPS_ADDR A:0x61e01828
y.create.l HWIO_APPS_SMMU_CBAR11_2_APPS_ADDR A:0x61e0102c
y.create.l HWIO_APPS_SMMU_CBFRSYNRA11_2_APPS_ADDR A:0x61e0142c
y.create.l HWIO_APPS_SMMU_CBA2R11_2_APPS_ADDR A:0x61e0182c
y.create.l HWIO_APPS_SMMU_CBAR12_2_APPS_ADDR A:0x61e01030
y.create.l HWIO_APPS_SMMU_CBFRSYNRA12_2_APPS_ADDR A:0x61e01430
y.create.l HWIO_APPS_SMMU_CBA2R12_2_APPS_ADDR A:0x61e01830
y.create.l HWIO_APPS_SMMU_CBAR13_2_APPS_ADDR A:0x61e01034
y.create.l HWIO_APPS_SMMU_CBFRSYNRA13_2_APPS_ADDR A:0x61e01434
y.create.l HWIO_APPS_SMMU_CBA2R13_2_APPS_ADDR A:0x61e01834
y.create.l HWIO_APPS_SMMU_CBAR14_2_APPS_ADDR A:0x61e01038
y.create.l HWIO_APPS_SMMU_CBFRSYNRA14_2_APPS_ADDR A:0x61e01438
y.create.l HWIO_APPS_SMMU_CBA2R14_2_APPS_ADDR A:0x61e01838
y.create.l HWIO_APPS_SMMU_CBAR15_2_APPS_ADDR A:0x61e0103c
y.create.l HWIO_APPS_SMMU_CBFRSYNRA15_2_APPS_ADDR A:0x61e0143c
y.create.l HWIO_APPS_SMMU_CBA2R15_2_APPS_ADDR A:0x61e0183c
y.create.l HWIO_APPS_SMMU_CBAR16_2_APPS_ADDR A:0x61e01040
y.create.l HWIO_APPS_SMMU_CBFRSYNRA16_2_APPS_ADDR A:0x61e01440
y.create.l HWIO_APPS_SMMU_CBA2R16_2_APPS_ADDR A:0x61e01840
y.create.l HWIO_APPS_SMMU_CBAR17_2_APPS_ADDR A:0x61e01044
y.create.l HWIO_APPS_SMMU_CBFRSYNRA17_2_APPS_ADDR A:0x61e01444
y.create.l HWIO_APPS_SMMU_CBA2R17_2_APPS_ADDR A:0x61e01844
y.create.l HWIO_APPS_SMMU_CBAR18_2_APPS_ADDR A:0x61e01048
y.create.l HWIO_APPS_SMMU_CBFRSYNRA18_2_APPS_ADDR A:0x61e01448
y.create.l HWIO_APPS_SMMU_CBA2R18_2_APPS_ADDR A:0x61e01848
y.create.l HWIO_APPS_SMMU_CBAR19_2_APPS_ADDR A:0x61e0104c
y.create.l HWIO_APPS_SMMU_CBFRSYNRA19_2_APPS_ADDR A:0x61e0144c
y.create.l HWIO_APPS_SMMU_CBA2R19_2_APPS_ADDR A:0x61e0184c
y.create.l HWIO_APPS_SMMU_CBAR20_2_APPS_ADDR A:0x61e01050
y.create.l HWIO_APPS_SMMU_CBFRSYNRA20_2_APPS_ADDR A:0x61e01450
y.create.l HWIO_APPS_SMMU_CBA2R20_2_APPS_ADDR A:0x61e01850
y.create.l HWIO_APPS_SMMU_CBAR21_2_APPS_ADDR A:0x61e01054
y.create.l HWIO_APPS_SMMU_CBFRSYNRA21_2_APPS_ADDR A:0x61e01454
y.create.l HWIO_APPS_SMMU_CBA2R21_2_APPS_ADDR A:0x61e01854
y.create.l HWIO_APPS_SMMU_CBAR22_2_APPS_ADDR A:0x61e01058
y.create.l HWIO_APPS_SMMU_CBFRSYNRA22_2_APPS_ADDR A:0x61e01458
y.create.l HWIO_APPS_SMMU_CBA2R22_2_APPS_ADDR A:0x61e01858
y.create.l HWIO_APPS_SMMU_CBAR23_2_APPS_ADDR A:0x61e0105c
y.create.l HWIO_APPS_SMMU_CBFRSYNRA23_2_APPS_ADDR A:0x61e0145c
y.create.l HWIO_APPS_SMMU_CBA2R23_2_APPS_ADDR A:0x61e0185c
y.create.l HWIO_APPS_SMMU_CBAR24_2_APPS_ADDR A:0x61e01060
y.create.l HWIO_APPS_SMMU_CBFRSYNRA24_2_APPS_ADDR A:0x61e01460
y.create.l HWIO_APPS_SMMU_CBA2R24_2_APPS_ADDR A:0x61e01860
y.create.l HWIO_APPS_SMMU_CBAR25_2_APPS_ADDR A:0x61e01064
y.create.l HWIO_APPS_SMMU_CBFRSYNRA25_2_APPS_ADDR A:0x61e01464
y.create.l HWIO_APPS_SMMU_CBA2R25_2_APPS_ADDR A:0x61e01864
y.create.l HWIO_APPS_SMMU_CBAR26_2_APPS_ADDR A:0x61e01068
y.create.l HWIO_APPS_SMMU_CBFRSYNRA26_2_APPS_ADDR A:0x61e01468
y.create.l HWIO_APPS_SMMU_CBA2R26_2_APPS_ADDR A:0x61e01868
y.create.l HWIO_APPS_SMMU_CBAR27_2_APPS_ADDR A:0x61e0106c
y.create.l HWIO_APPS_SMMU_CBFRSYNRA27_2_APPS_ADDR A:0x61e0146c
y.create.l HWIO_APPS_SMMU_CBA2R27_2_APPS_ADDR A:0x61e0186c
y.create.l HWIO_APPS_SMMU_CBAR28_2_APPS_ADDR A:0x61e01070
y.create.l HWIO_APPS_SMMU_CBFRSYNRA28_2_APPS_ADDR A:0x61e01470
y.create.l HWIO_APPS_SMMU_CBA2R28_2_APPS_ADDR A:0x61e01870
y.create.l HWIO_APPS_SMMU_CBAR29_2_APPS_ADDR A:0x61e01074
y.create.l HWIO_APPS_SMMU_CBFRSYNRA29_2_APPS_ADDR A:0x61e01474
y.create.l HWIO_APPS_SMMU_CBA2R29_2_APPS_ADDR A:0x61e01874
y.create.l HWIO_APPS_SMMU_CBAR30_2_APPS_ADDR A:0x61e01078
y.create.l HWIO_APPS_SMMU_CBFRSYNRA30_2_APPS_ADDR A:0x61e01478
y.create.l HWIO_APPS_SMMU_CBA2R30_2_APPS_ADDR A:0x61e01878
y.create.l HWIO_APPS_SMMU_CBAR31_2_APPS_ADDR A:0x61e0107c
y.create.l HWIO_APPS_SMMU_CBFRSYNRA31_2_APPS_ADDR A:0x61e0147c
y.create.l HWIO_APPS_SMMU_CBA2R31_2_APPS_ADDR A:0x61e0187c
y.create.l HWIO_APPS_PMEVCNTR0_2_APPS_ADDR A:0x61e03000
y.create.l HWIO_APPS_PMEVCNTR1_2_APPS_ADDR A:0x61e03004
y.create.l HWIO_APPS_PMEVCNTR2_2_APPS_ADDR A:0x61e03008
y.create.l HWIO_APPS_PMEVCNTR3_2_APPS_ADDR A:0x61e0300c
y.create.l HWIO_APPS_PMEVTYPER0_2_APPS_ADDR A:0x61e03400
y.create.l HWIO_APPS_PMEVTYPER1_2_APPS_ADDR A:0x61e03404
y.create.l HWIO_APPS_PMEVTYPER2_2_APPS_ADDR A:0x61e03408
y.create.l HWIO_APPS_PMEVTYPER3_2_APPS_ADDR A:0x61e0340c
y.create.l HWIO_APPS_PMCGCR_2_APPS_ADDR A:0x61e03800
y.create.l HWIO_APPS_PMCGSMR_2_APPS_ADDR A:0x61e03a00
y.create.l HWIO_APPS_PMCNTENSET_2_APPS_ADDR A:0x61e03c00
y.create.l HWIO_APPS_PMCNTENCLR_2_APPS_ADDR A:0x61e03c20
y.create.l HWIO_APPS_PMINTENSET_2_APPS_ADDR A:0x61e03c40
y.create.l HWIO_APPS_PMINTENCLR_2_APPS_ADDR A:0x61e03c60
y.create.l HWIO_APPS_PMOVSCLR_2_APPS_ADDR A:0x61e03c80
y.create.l HWIO_APPS_PMOVSSET_2_APPS_ADDR A:0x61e03cc0
y.create.l HWIO_APPS_PMCFGR_2_APPS_ADDR A:0x61e03e00
y.create.l HWIO_APPS_PMCR_2_APPS_ADDR A:0x61e03e04
y.create.l HWIO_APPS_PMCEID0_2_APPS_ADDR A:0x61e03e20
y.create.l HWIO_APPS_PMAUTHSTATUS_2_APPS_ADDR A:0x61e03fb8
y.create.l HWIO_APPS_PMDEVTYPE_2_APPS_ADDR A:0x61e03fcc
y.create.l HWIO_APPS_SMMU_CB0_SCTLR_2_APPS_ADDR A:0x61e20000
y.create.l HWIO_APPS_SMMU_CB1_SCTLR_2_APPS_ADDR A:0x61e21000
y.create.l HWIO_APPS_SMMU_CB2_SCTLR_2_APPS_ADDR A:0x61e22000
y.create.l HWIO_APPS_SMMU_CB3_SCTLR_2_APPS_ADDR A:0x61e23000
y.create.l HWIO_APPS_SMMU_CB4_SCTLR_2_APPS_ADDR A:0x61e24000
y.create.l HWIO_APPS_SMMU_CB5_SCTLR_2_APPS_ADDR A:0x61e25000
y.create.l HWIO_APPS_SMMU_CB6_SCTLR_2_APPS_ADDR A:0x61e26000
y.create.l HWIO_APPS_SMMU_CB7_SCTLR_2_APPS_ADDR A:0x61e27000
y.create.l HWIO_APPS_SMMU_CB8_SCTLR_2_APPS_ADDR A:0x61e28000
y.create.l HWIO_APPS_SMMU_CB9_SCTLR_2_APPS_ADDR A:0x61e29000
y.create.l HWIO_APPS_SMMU_CB10_SCTLR_2_APPS_ADDR A:0x61e2a000
y.create.l HWIO_APPS_SMMU_CB11_SCTLR_2_APPS_ADDR A:0x61e2b000
y.create.l HWIO_APPS_SMMU_CB12_SCTLR_2_APPS_ADDR A:0x61e2c000
y.create.l HWIO_APPS_SMMU_CB13_SCTLR_2_APPS_ADDR A:0x61e2d000
y.create.l HWIO_APPS_SMMU_CB14_SCTLR_2_APPS_ADDR A:0x61e2e000
y.create.l HWIO_APPS_SMMU_CB15_SCTLR_2_APPS_ADDR A:0x61e2f000
y.create.l HWIO_APPS_SMMU_CB16_SCTLR_2_APPS_ADDR A:0x61e30000
y.create.l HWIO_APPS_SMMU_CB17_SCTLR_2_APPS_ADDR A:0x61e31000
y.create.l HWIO_APPS_SMMU_CB18_SCTLR_2_APPS_ADDR A:0x61e32000
y.create.l HWIO_APPS_SMMU_CB19_SCTLR_2_APPS_ADDR A:0x61e33000
y.create.l HWIO_APPS_SMMU_CB20_SCTLR_2_APPS_ADDR A:0x61e34000
y.create.l HWIO_APPS_SMMU_CB21_SCTLR_2_APPS_ADDR A:0x61e35000
y.create.l HWIO_APPS_SMMU_CB22_SCTLR_2_APPS_ADDR A:0x61e36000
y.create.l HWIO_APPS_SMMU_CB23_SCTLR_2_APPS_ADDR A:0x61e37000
y.create.l HWIO_APPS_SMMU_CB24_SCTLR_2_APPS_ADDR A:0x61e38000
y.create.l HWIO_APPS_SMMU_CB25_SCTLR_2_APPS_ADDR A:0x61e39000
y.create.l HWIO_APPS_SMMU_CB26_SCTLR_2_APPS_ADDR A:0x61e3a000
y.create.l HWIO_APPS_SMMU_CB27_SCTLR_2_APPS_ADDR A:0x61e3b000
y.create.l HWIO_APPS_SMMU_CB28_SCTLR_2_APPS_ADDR A:0x61e3c000
y.create.l HWIO_APPS_SMMU_CB29_SCTLR_2_APPS_ADDR A:0x61e3d000
y.create.l HWIO_APPS_SMMU_CB30_SCTLR_2_APPS_ADDR A:0x61e3e000
y.create.l HWIO_APPS_SMMU_CB31_SCTLR_2_APPS_ADDR A:0x61e3f000
y.create.l HWIO_APPS_SMMU_CB0_ACTLR_2_APPS_ADDR A:0x61e20004
y.create.l HWIO_APPS_SMMU_CB1_ACTLR_2_APPS_ADDR A:0x61e21004
y.create.l HWIO_APPS_SMMU_CB2_ACTLR_2_APPS_ADDR A:0x61e22004
y.create.l HWIO_APPS_SMMU_CB3_ACTLR_2_APPS_ADDR A:0x61e23004
y.create.l HWIO_APPS_SMMU_CB4_ACTLR_2_APPS_ADDR A:0x61e24004
y.create.l HWIO_APPS_SMMU_CB5_ACTLR_2_APPS_ADDR A:0x61e25004
y.create.l HWIO_APPS_SMMU_CB6_ACTLR_2_APPS_ADDR A:0x61e26004
y.create.l HWIO_APPS_SMMU_CB7_ACTLR_2_APPS_ADDR A:0x61e27004
y.create.l HWIO_APPS_SMMU_CB8_ACTLR_2_APPS_ADDR A:0x61e28004
y.create.l HWIO_APPS_SMMU_CB9_ACTLR_2_APPS_ADDR A:0x61e29004
y.create.l HWIO_APPS_SMMU_CB10_ACTLR_2_APPS_ADDR A:0x61e2a004
y.create.l HWIO_APPS_SMMU_CB11_ACTLR_2_APPS_ADDR A:0x61e2b004
y.create.l HWIO_APPS_SMMU_CB12_ACTLR_2_APPS_ADDR A:0x61e2c004
y.create.l HWIO_APPS_SMMU_CB13_ACTLR_2_APPS_ADDR A:0x61e2d004
y.create.l HWIO_APPS_SMMU_CB14_ACTLR_2_APPS_ADDR A:0x61e2e004
y.create.l HWIO_APPS_SMMU_CB15_ACTLR_2_APPS_ADDR A:0x61e2f004
y.create.l HWIO_APPS_SMMU_CB16_ACTLR_2_APPS_ADDR A:0x61e30004
y.create.l HWIO_APPS_SMMU_CB17_ACTLR_2_APPS_ADDR A:0x61e31004
y.create.l HWIO_APPS_SMMU_CB18_ACTLR_2_APPS_ADDR A:0x61e32004
y.create.l HWIO_APPS_SMMU_CB19_ACTLR_2_APPS_ADDR A:0x61e33004
y.create.l HWIO_APPS_SMMU_CB20_ACTLR_2_APPS_ADDR A:0x61e34004
y.create.l HWIO_APPS_SMMU_CB21_ACTLR_2_APPS_ADDR A:0x61e35004
y.create.l HWIO_APPS_SMMU_CB22_ACTLR_2_APPS_ADDR A:0x61e36004
y.create.l HWIO_APPS_SMMU_CB23_ACTLR_2_APPS_ADDR A:0x61e37004
y.create.l HWIO_APPS_SMMU_CB24_ACTLR_2_APPS_ADDR A:0x61e38004
y.create.l HWIO_APPS_SMMU_CB25_ACTLR_2_APPS_ADDR A:0x61e39004
y.create.l HWIO_APPS_SMMU_CB26_ACTLR_2_APPS_ADDR A:0x61e3a004
y.create.l HWIO_APPS_SMMU_CB27_ACTLR_2_APPS_ADDR A:0x61e3b004
y.create.l HWIO_APPS_SMMU_CB28_ACTLR_2_APPS_ADDR A:0x61e3c004
y.create.l HWIO_APPS_SMMU_CB29_ACTLR_2_APPS_ADDR A:0x61e3d004
y.create.l HWIO_APPS_SMMU_CB30_ACTLR_2_APPS_ADDR A:0x61e3e004
y.create.l HWIO_APPS_SMMU_CB31_ACTLR_2_APPS_ADDR A:0x61e3f004
y.create.l HWIO_APPS_SMMU_CB0_RESUME_2_APPS_ADDR A:0x61e20008
y.create.l HWIO_APPS_SMMU_CB1_RESUME_2_APPS_ADDR A:0x61e21008
y.create.l HWIO_APPS_SMMU_CB2_RESUME_2_APPS_ADDR A:0x61e22008
y.create.l HWIO_APPS_SMMU_CB3_RESUME_2_APPS_ADDR A:0x61e23008
y.create.l HWIO_APPS_SMMU_CB4_RESUME_2_APPS_ADDR A:0x61e24008
y.create.l HWIO_APPS_SMMU_CB5_RESUME_2_APPS_ADDR A:0x61e25008
y.create.l HWIO_APPS_SMMU_CB6_RESUME_2_APPS_ADDR A:0x61e26008
y.create.l HWIO_APPS_SMMU_CB7_RESUME_2_APPS_ADDR A:0x61e27008
y.create.l HWIO_APPS_SMMU_CB8_RESUME_2_APPS_ADDR A:0x61e28008
y.create.l HWIO_APPS_SMMU_CB9_RESUME_2_APPS_ADDR A:0x61e29008
y.create.l HWIO_APPS_SMMU_CB10_RESUME_2_APPS_ADDR A:0x61e2a008
y.create.l HWIO_APPS_SMMU_CB11_RESUME_2_APPS_ADDR A:0x61e2b008
y.create.l HWIO_APPS_SMMU_CB12_RESUME_2_APPS_ADDR A:0x61e2c008
y.create.l HWIO_APPS_SMMU_CB13_RESUME_2_APPS_ADDR A:0x61e2d008
y.create.l HWIO_APPS_SMMU_CB14_RESUME_2_APPS_ADDR A:0x61e2e008
y.create.l HWIO_APPS_SMMU_CB15_RESUME_2_APPS_ADDR A:0x61e2f008
y.create.l HWIO_APPS_SMMU_CB16_RESUME_2_APPS_ADDR A:0x61e30008
y.create.l HWIO_APPS_SMMU_CB17_RESUME_2_APPS_ADDR A:0x61e31008
y.create.l HWIO_APPS_SMMU_CB18_RESUME_2_APPS_ADDR A:0x61e32008
y.create.l HWIO_APPS_SMMU_CB19_RESUME_2_APPS_ADDR A:0x61e33008
y.create.l HWIO_APPS_SMMU_CB20_RESUME_2_APPS_ADDR A:0x61e34008
y.create.l HWIO_APPS_SMMU_CB21_RESUME_2_APPS_ADDR A:0x61e35008
y.create.l HWIO_APPS_SMMU_CB22_RESUME_2_APPS_ADDR A:0x61e36008
y.create.l HWIO_APPS_SMMU_CB23_RESUME_2_APPS_ADDR A:0x61e37008
y.create.l HWIO_APPS_SMMU_CB24_RESUME_2_APPS_ADDR A:0x61e38008
y.create.l HWIO_APPS_SMMU_CB25_RESUME_2_APPS_ADDR A:0x61e39008
y.create.l HWIO_APPS_SMMU_CB26_RESUME_2_APPS_ADDR A:0x61e3a008
y.create.l HWIO_APPS_SMMU_CB27_RESUME_2_APPS_ADDR A:0x61e3b008
y.create.l HWIO_APPS_SMMU_CB28_RESUME_2_APPS_ADDR A:0x61e3c008
y.create.l HWIO_APPS_SMMU_CB29_RESUME_2_APPS_ADDR A:0x61e3d008
y.create.l HWIO_APPS_SMMU_CB30_RESUME_2_APPS_ADDR A:0x61e3e008
y.create.l HWIO_APPS_SMMU_CB31_RESUME_2_APPS_ADDR A:0x61e3f008
y.create.l HWIO_APPS_SMMU_CB0_TCR2_2_APPS_ADDR A:0x61e20010
y.create.l HWIO_APPS_SMMU_CB1_TCR2_2_APPS_ADDR A:0x61e21010
y.create.l HWIO_APPS_SMMU_CB2_TCR2_2_APPS_ADDR A:0x61e22010
y.create.l HWIO_APPS_SMMU_CB3_TCR2_2_APPS_ADDR A:0x61e23010
y.create.l HWIO_APPS_SMMU_CB4_TCR2_2_APPS_ADDR A:0x61e24010
y.create.l HWIO_APPS_SMMU_CB5_TCR2_2_APPS_ADDR A:0x61e25010
y.create.l HWIO_APPS_SMMU_CB6_TCR2_2_APPS_ADDR A:0x61e26010
y.create.l HWIO_APPS_SMMU_CB7_TCR2_2_APPS_ADDR A:0x61e27010
y.create.l HWIO_APPS_SMMU_CB8_TCR2_2_APPS_ADDR A:0x61e28010
y.create.l HWIO_APPS_SMMU_CB9_TCR2_2_APPS_ADDR A:0x61e29010
y.create.l HWIO_APPS_SMMU_CB10_TCR2_2_APPS_ADDR A:0x61e2a010
y.create.l HWIO_APPS_SMMU_CB11_TCR2_2_APPS_ADDR A:0x61e2b010
y.create.l HWIO_APPS_SMMU_CB12_TCR2_2_APPS_ADDR A:0x61e2c010
y.create.l HWIO_APPS_SMMU_CB13_TCR2_2_APPS_ADDR A:0x61e2d010
y.create.l HWIO_APPS_SMMU_CB14_TCR2_2_APPS_ADDR A:0x61e2e010
y.create.l HWIO_APPS_SMMU_CB15_TCR2_2_APPS_ADDR A:0x61e2f010
y.create.l HWIO_APPS_SMMU_CB16_TCR2_2_APPS_ADDR A:0x61e30010
y.create.l HWIO_APPS_SMMU_CB17_TCR2_2_APPS_ADDR A:0x61e31010
y.create.l HWIO_APPS_SMMU_CB18_TCR2_2_APPS_ADDR A:0x61e32010
y.create.l HWIO_APPS_SMMU_CB19_TCR2_2_APPS_ADDR A:0x61e33010
y.create.l HWIO_APPS_SMMU_CB20_TCR2_2_APPS_ADDR A:0x61e34010
y.create.l HWIO_APPS_SMMU_CB21_TCR2_2_APPS_ADDR A:0x61e35010
y.create.l HWIO_APPS_SMMU_CB22_TCR2_2_APPS_ADDR A:0x61e36010
y.create.l HWIO_APPS_SMMU_CB23_TCR2_2_APPS_ADDR A:0x61e37010
y.create.l HWIO_APPS_SMMU_CB24_TCR2_2_APPS_ADDR A:0x61e38010
y.create.l HWIO_APPS_SMMU_CB25_TCR2_2_APPS_ADDR A:0x61e39010
y.create.l HWIO_APPS_SMMU_CB26_TCR2_2_APPS_ADDR A:0x61e3a010
y.create.l HWIO_APPS_SMMU_CB27_TCR2_2_APPS_ADDR A:0x61e3b010
y.create.l HWIO_APPS_SMMU_CB28_TCR2_2_APPS_ADDR A:0x61e3c010
y.create.l HWIO_APPS_SMMU_CB29_TCR2_2_APPS_ADDR A:0x61e3d010
y.create.l HWIO_APPS_SMMU_CB30_TCR2_2_APPS_ADDR A:0x61e3e010
y.create.l HWIO_APPS_SMMU_CB31_TCR2_2_APPS_ADDR A:0x61e3f010
y.create.l HWIO_APPS_SMMU_CB0_TTBR0_LOW_2_APPS_ADDR A:0x61e20020
y.create.l HWIO_APPS_SMMU_CB1_TTBR0_LOW_2_APPS_ADDR A:0x61e21020
y.create.l HWIO_APPS_SMMU_CB2_TTBR0_LOW_2_APPS_ADDR A:0x61e22020
y.create.l HWIO_APPS_SMMU_CB3_TTBR0_LOW_2_APPS_ADDR A:0x61e23020
y.create.l HWIO_APPS_SMMU_CB4_TTBR0_LOW_2_APPS_ADDR A:0x61e24020
y.create.l HWIO_APPS_SMMU_CB5_TTBR0_LOW_2_APPS_ADDR A:0x61e25020
y.create.l HWIO_APPS_SMMU_CB6_TTBR0_LOW_2_APPS_ADDR A:0x61e26020
y.create.l HWIO_APPS_SMMU_CB7_TTBR0_LOW_2_APPS_ADDR A:0x61e27020
y.create.l HWIO_APPS_SMMU_CB8_TTBR0_LOW_2_APPS_ADDR A:0x61e28020
y.create.l HWIO_APPS_SMMU_CB9_TTBR0_LOW_2_APPS_ADDR A:0x61e29020
y.create.l HWIO_APPS_SMMU_CB10_TTBR0_LOW_2_APPS_ADDR A:0x61e2a020
y.create.l HWIO_APPS_SMMU_CB11_TTBR0_LOW_2_APPS_ADDR A:0x61e2b020
y.create.l HWIO_APPS_SMMU_CB12_TTBR0_LOW_2_APPS_ADDR A:0x61e2c020
y.create.l HWIO_APPS_SMMU_CB13_TTBR0_LOW_2_APPS_ADDR A:0x61e2d020
y.create.l HWIO_APPS_SMMU_CB14_TTBR0_LOW_2_APPS_ADDR A:0x61e2e020
y.create.l HWIO_APPS_SMMU_CB15_TTBR0_LOW_2_APPS_ADDR A:0x61e2f020
y.create.l HWIO_APPS_SMMU_CB16_TTBR0_LOW_2_APPS_ADDR A:0x61e30020
y.create.l HWIO_APPS_SMMU_CB17_TTBR0_LOW_2_APPS_ADDR A:0x61e31020
y.create.l HWIO_APPS_SMMU_CB18_TTBR0_LOW_2_APPS_ADDR A:0x61e32020
y.create.l HWIO_APPS_SMMU_CB19_TTBR0_LOW_2_APPS_ADDR A:0x61e33020
y.create.l HWIO_APPS_SMMU_CB20_TTBR0_LOW_2_APPS_ADDR A:0x61e34020
y.create.l HWIO_APPS_SMMU_CB21_TTBR0_LOW_2_APPS_ADDR A:0x61e35020
y.create.l HWIO_APPS_SMMU_CB22_TTBR0_LOW_2_APPS_ADDR A:0x61e36020
y.create.l HWIO_APPS_SMMU_CB23_TTBR0_LOW_2_APPS_ADDR A:0x61e37020
y.create.l HWIO_APPS_SMMU_CB24_TTBR0_LOW_2_APPS_ADDR A:0x61e38020
y.create.l HWIO_APPS_SMMU_CB25_TTBR0_LOW_2_APPS_ADDR A:0x61e39020
y.create.l HWIO_APPS_SMMU_CB26_TTBR0_LOW_2_APPS_ADDR A:0x61e3a020
y.create.l HWIO_APPS_SMMU_CB27_TTBR0_LOW_2_APPS_ADDR A:0x61e3b020
y.create.l HWIO_APPS_SMMU_CB28_TTBR0_LOW_2_APPS_ADDR A:0x61e3c020
y.create.l HWIO_APPS_SMMU_CB29_TTBR0_LOW_2_APPS_ADDR A:0x61e3d020
y.create.l HWIO_APPS_SMMU_CB30_TTBR0_LOW_2_APPS_ADDR A:0x61e3e020
y.create.l HWIO_APPS_SMMU_CB31_TTBR0_LOW_2_APPS_ADDR A:0x61e3f020
y.create.l HWIO_APPS_SMMU_CB0_TTBR0_HIGH_2_APPS_ADDR A:0x61e20024
y.create.l HWIO_APPS_SMMU_CB1_TTBR0_HIGH_2_APPS_ADDR A:0x61e21024
y.create.l HWIO_APPS_SMMU_CB2_TTBR0_HIGH_2_APPS_ADDR A:0x61e22024
y.create.l HWIO_APPS_SMMU_CB3_TTBR0_HIGH_2_APPS_ADDR A:0x61e23024
y.create.l HWIO_APPS_SMMU_CB4_TTBR0_HIGH_2_APPS_ADDR A:0x61e24024
y.create.l HWIO_APPS_SMMU_CB5_TTBR0_HIGH_2_APPS_ADDR A:0x61e25024
y.create.l HWIO_APPS_SMMU_CB6_TTBR0_HIGH_2_APPS_ADDR A:0x61e26024
y.create.l HWIO_APPS_SMMU_CB7_TTBR0_HIGH_2_APPS_ADDR A:0x61e27024
y.create.l HWIO_APPS_SMMU_CB8_TTBR0_HIGH_2_APPS_ADDR A:0x61e28024
y.create.l HWIO_APPS_SMMU_CB9_TTBR0_HIGH_2_APPS_ADDR A:0x61e29024
y.create.l HWIO_APPS_SMMU_CB10_TTBR0_HIGH_2_APPS_ADDR A:0x61e2a024
y.create.l HWIO_APPS_SMMU_CB11_TTBR0_HIGH_2_APPS_ADDR A:0x61e2b024
y.create.l HWIO_APPS_SMMU_CB12_TTBR0_HIGH_2_APPS_ADDR A:0x61e2c024
y.create.l HWIO_APPS_SMMU_CB13_TTBR0_HIGH_2_APPS_ADDR A:0x61e2d024
y.create.l HWIO_APPS_SMMU_CB14_TTBR0_HIGH_2_APPS_ADDR A:0x61e2e024
y.create.l HWIO_APPS_SMMU_CB15_TTBR0_HIGH_2_APPS_ADDR A:0x61e2f024
y.create.l HWIO_APPS_SMMU_CB16_TTBR0_HIGH_2_APPS_ADDR A:0x61e30024
y.create.l HWIO_APPS_SMMU_CB17_TTBR0_HIGH_2_APPS_ADDR A:0x61e31024
y.create.l HWIO_APPS_SMMU_CB18_TTBR0_HIGH_2_APPS_ADDR A:0x61e32024
y.create.l HWIO_APPS_SMMU_CB19_TTBR0_HIGH_2_APPS_ADDR A:0x61e33024
y.create.l HWIO_APPS_SMMU_CB20_TTBR0_HIGH_2_APPS_ADDR A:0x61e34024
y.create.l HWIO_APPS_SMMU_CB21_TTBR0_HIGH_2_APPS_ADDR A:0x61e35024
y.create.l HWIO_APPS_SMMU_CB22_TTBR0_HIGH_2_APPS_ADDR A:0x61e36024
y.create.l HWIO_APPS_SMMU_CB23_TTBR0_HIGH_2_APPS_ADDR A:0x61e37024
y.create.l HWIO_APPS_SMMU_CB24_TTBR0_HIGH_2_APPS_ADDR A:0x61e38024
y.create.l HWIO_APPS_SMMU_CB25_TTBR0_HIGH_2_APPS_ADDR A:0x61e39024
y.create.l HWIO_APPS_SMMU_CB26_TTBR0_HIGH_2_APPS_ADDR A:0x61e3a024
y.create.l HWIO_APPS_SMMU_CB27_TTBR0_HIGH_2_APPS_ADDR A:0x61e3b024
y.create.l HWIO_APPS_SMMU_CB28_TTBR0_HIGH_2_APPS_ADDR A:0x61e3c024
y.create.l HWIO_APPS_SMMU_CB29_TTBR0_HIGH_2_APPS_ADDR A:0x61e3d024
y.create.l HWIO_APPS_SMMU_CB30_TTBR0_HIGH_2_APPS_ADDR A:0x61e3e024
y.create.l HWIO_APPS_SMMU_CB31_TTBR0_HIGH_2_APPS_ADDR A:0x61e3f024
y.create.l HWIO_APPS_SMMU_CB0_TTBR1_LOW_2_APPS_ADDR A:0x61e20028
y.create.l HWIO_APPS_SMMU_CB1_TTBR1_LOW_2_APPS_ADDR A:0x61e21028
y.create.l HWIO_APPS_SMMU_CB2_TTBR1_LOW_2_APPS_ADDR A:0x61e22028
y.create.l HWIO_APPS_SMMU_CB3_TTBR1_LOW_2_APPS_ADDR A:0x61e23028
y.create.l HWIO_APPS_SMMU_CB4_TTBR1_LOW_2_APPS_ADDR A:0x61e24028
y.create.l HWIO_APPS_SMMU_CB5_TTBR1_LOW_2_APPS_ADDR A:0x61e25028
y.create.l HWIO_APPS_SMMU_CB6_TTBR1_LOW_2_APPS_ADDR A:0x61e26028
y.create.l HWIO_APPS_SMMU_CB7_TTBR1_LOW_2_APPS_ADDR A:0x61e27028
y.create.l HWIO_APPS_SMMU_CB8_TTBR1_LOW_2_APPS_ADDR A:0x61e28028
y.create.l HWIO_APPS_SMMU_CB9_TTBR1_LOW_2_APPS_ADDR A:0x61e29028
y.create.l HWIO_APPS_SMMU_CB10_TTBR1_LOW_2_APPS_ADDR A:0x61e2a028
y.create.l HWIO_APPS_SMMU_CB11_TTBR1_LOW_2_APPS_ADDR A:0x61e2b028
y.create.l HWIO_APPS_SMMU_CB12_TTBR1_LOW_2_APPS_ADDR A:0x61e2c028
y.create.l HWIO_APPS_SMMU_CB13_TTBR1_LOW_2_APPS_ADDR A:0x61e2d028
y.create.l HWIO_APPS_SMMU_CB14_TTBR1_LOW_2_APPS_ADDR A:0x61e2e028
y.create.l HWIO_APPS_SMMU_CB15_TTBR1_LOW_2_APPS_ADDR A:0x61e2f028
y.create.l HWIO_APPS_SMMU_CB16_TTBR1_LOW_2_APPS_ADDR A:0x61e30028
y.create.l HWIO_APPS_SMMU_CB17_TTBR1_LOW_2_APPS_ADDR A:0x61e31028
y.create.l HWIO_APPS_SMMU_CB18_TTBR1_LOW_2_APPS_ADDR A:0x61e32028
y.create.l HWIO_APPS_SMMU_CB19_TTBR1_LOW_2_APPS_ADDR A:0x61e33028
y.create.l HWIO_APPS_SMMU_CB20_TTBR1_LOW_2_APPS_ADDR A:0x61e34028
y.create.l HWIO_APPS_SMMU_CB21_TTBR1_LOW_2_APPS_ADDR A:0x61e35028
y.create.l HWIO_APPS_SMMU_CB22_TTBR1_LOW_2_APPS_ADDR A:0x61e36028
y.create.l HWIO_APPS_SMMU_CB23_TTBR1_LOW_2_APPS_ADDR A:0x61e37028
y.create.l HWIO_APPS_SMMU_CB24_TTBR1_LOW_2_APPS_ADDR A:0x61e38028
y.create.l HWIO_APPS_SMMU_CB25_TTBR1_LOW_2_APPS_ADDR A:0x61e39028
y.create.l HWIO_APPS_SMMU_CB26_TTBR1_LOW_2_APPS_ADDR A:0x61e3a028
y.create.l HWIO_APPS_SMMU_CB27_TTBR1_LOW_2_APPS_ADDR A:0x61e3b028
y.create.l HWIO_APPS_SMMU_CB28_TTBR1_LOW_2_APPS_ADDR A:0x61e3c028
y.create.l HWIO_APPS_SMMU_CB29_TTBR1_LOW_2_APPS_ADDR A:0x61e3d028
y.create.l HWIO_APPS_SMMU_CB30_TTBR1_LOW_2_APPS_ADDR A:0x61e3e028
y.create.l HWIO_APPS_SMMU_CB31_TTBR1_LOW_2_APPS_ADDR A:0x61e3f028
y.create.l HWIO_APPS_SMMU_CB0_TTBR1_HIGH_2_APPS_ADDR A:0x61e2002c
y.create.l HWIO_APPS_SMMU_CB1_TTBR1_HIGH_2_APPS_ADDR A:0x61e2102c
y.create.l HWIO_APPS_SMMU_CB2_TTBR1_HIGH_2_APPS_ADDR A:0x61e2202c
y.create.l HWIO_APPS_SMMU_CB3_TTBR1_HIGH_2_APPS_ADDR A:0x61e2302c
y.create.l HWIO_APPS_SMMU_CB4_TTBR1_HIGH_2_APPS_ADDR A:0x61e2402c
y.create.l HWIO_APPS_SMMU_CB5_TTBR1_HIGH_2_APPS_ADDR A:0x61e2502c
y.create.l HWIO_APPS_SMMU_CB6_TTBR1_HIGH_2_APPS_ADDR A:0x61e2602c
y.create.l HWIO_APPS_SMMU_CB7_TTBR1_HIGH_2_APPS_ADDR A:0x61e2702c
y.create.l HWIO_APPS_SMMU_CB8_TTBR1_HIGH_2_APPS_ADDR A:0x61e2802c
y.create.l HWIO_APPS_SMMU_CB9_TTBR1_HIGH_2_APPS_ADDR A:0x61e2902c
y.create.l HWIO_APPS_SMMU_CB10_TTBR1_HIGH_2_APPS_ADDR A:0x61e2a02c
y.create.l HWIO_APPS_SMMU_CB11_TTBR1_HIGH_2_APPS_ADDR A:0x61e2b02c
y.create.l HWIO_APPS_SMMU_CB12_TTBR1_HIGH_2_APPS_ADDR A:0x61e2c02c
y.create.l HWIO_APPS_SMMU_CB13_TTBR1_HIGH_2_APPS_ADDR A:0x61e2d02c
y.create.l HWIO_APPS_SMMU_CB14_TTBR1_HIGH_2_APPS_ADDR A:0x61e2e02c
y.create.l HWIO_APPS_SMMU_CB15_TTBR1_HIGH_2_APPS_ADDR A:0x61e2f02c
y.create.l HWIO_APPS_SMMU_CB16_TTBR1_HIGH_2_APPS_ADDR A:0x61e3002c
y.create.l HWIO_APPS_SMMU_CB17_TTBR1_HIGH_2_APPS_ADDR A:0x61e3102c
y.create.l HWIO_APPS_SMMU_CB18_TTBR1_HIGH_2_APPS_ADDR A:0x61e3202c
y.create.l HWIO_APPS_SMMU_CB19_TTBR1_HIGH_2_APPS_ADDR A:0x61e3302c
y.create.l HWIO_APPS_SMMU_CB20_TTBR1_HIGH_2_APPS_ADDR A:0x61e3402c
y.create.l HWIO_APPS_SMMU_CB21_TTBR1_HIGH_2_APPS_ADDR A:0x61e3502c
y.create.l HWIO_APPS_SMMU_CB22_TTBR1_HIGH_2_APPS_ADDR A:0x61e3602c
y.create.l HWIO_APPS_SMMU_CB23_TTBR1_HIGH_2_APPS_ADDR A:0x61e3702c
y.create.l HWIO_APPS_SMMU_CB24_TTBR1_HIGH_2_APPS_ADDR A:0x61e3802c
y.create.l HWIO_APPS_SMMU_CB25_TTBR1_HIGH_2_APPS_ADDR A:0x61e3902c
y.create.l HWIO_APPS_SMMU_CB26_TTBR1_HIGH_2_APPS_ADDR A:0x61e3a02c
y.create.l HWIO_APPS_SMMU_CB27_TTBR1_HIGH_2_APPS_ADDR A:0x61e3b02c
y.create.l HWIO_APPS_SMMU_CB28_TTBR1_HIGH_2_APPS_ADDR A:0x61e3c02c
y.create.l HWIO_APPS_SMMU_CB29_TTBR1_HIGH_2_APPS_ADDR A:0x61e3d02c
y.create.l HWIO_APPS_SMMU_CB30_TTBR1_HIGH_2_APPS_ADDR A:0x61e3e02c
y.create.l HWIO_APPS_SMMU_CB31_TTBR1_HIGH_2_APPS_ADDR A:0x61e3f02c
y.create.l HWIO_APPS_SMMU_CB0_TCR_LPAE_2_APPS_ADDR A:0x61e20030
y.create.l HWIO_APPS_SMMU_CB1_TCR_LPAE_2_APPS_ADDR A:0x61e21030
y.create.l HWIO_APPS_SMMU_CB2_TCR_LPAE_2_APPS_ADDR A:0x61e22030
y.create.l HWIO_APPS_SMMU_CB3_TCR_LPAE_2_APPS_ADDR A:0x61e23030
y.create.l HWIO_APPS_SMMU_CB4_TCR_LPAE_2_APPS_ADDR A:0x61e24030
y.create.l HWIO_APPS_SMMU_CB5_TCR_LPAE_2_APPS_ADDR A:0x61e25030
y.create.l HWIO_APPS_SMMU_CB6_TCR_LPAE_2_APPS_ADDR A:0x61e26030
y.create.l HWIO_APPS_SMMU_CB7_TCR_LPAE_2_APPS_ADDR A:0x61e27030
y.create.l HWIO_APPS_SMMU_CB8_TCR_LPAE_2_APPS_ADDR A:0x61e28030
y.create.l HWIO_APPS_SMMU_CB9_TCR_LPAE_2_APPS_ADDR A:0x61e29030
y.create.l HWIO_APPS_SMMU_CB10_TCR_LPAE_2_APPS_ADDR A:0x61e2a030
y.create.l HWIO_APPS_SMMU_CB11_TCR_LPAE_2_APPS_ADDR A:0x61e2b030
y.create.l HWIO_APPS_SMMU_CB12_TCR_LPAE_2_APPS_ADDR A:0x61e2c030
y.create.l HWIO_APPS_SMMU_CB13_TCR_LPAE_2_APPS_ADDR A:0x61e2d030
y.create.l HWIO_APPS_SMMU_CB14_TCR_LPAE_2_APPS_ADDR A:0x61e2e030
y.create.l HWIO_APPS_SMMU_CB15_TCR_LPAE_2_APPS_ADDR A:0x61e2f030
y.create.l HWIO_APPS_SMMU_CB16_TCR_LPAE_2_APPS_ADDR A:0x61e30030
y.create.l HWIO_APPS_SMMU_CB17_TCR_LPAE_2_APPS_ADDR A:0x61e31030
y.create.l HWIO_APPS_SMMU_CB18_TCR_LPAE_2_APPS_ADDR A:0x61e32030
y.create.l HWIO_APPS_SMMU_CB19_TCR_LPAE_2_APPS_ADDR A:0x61e33030
y.create.l HWIO_APPS_SMMU_CB20_TCR_LPAE_2_APPS_ADDR A:0x61e34030
y.create.l HWIO_APPS_SMMU_CB21_TCR_LPAE_2_APPS_ADDR A:0x61e35030
y.create.l HWIO_APPS_SMMU_CB22_TCR_LPAE_2_APPS_ADDR A:0x61e36030
y.create.l HWIO_APPS_SMMU_CB23_TCR_LPAE_2_APPS_ADDR A:0x61e37030
y.create.l HWIO_APPS_SMMU_CB24_TCR_LPAE_2_APPS_ADDR A:0x61e38030
y.create.l HWIO_APPS_SMMU_CB25_TCR_LPAE_2_APPS_ADDR A:0x61e39030
y.create.l HWIO_APPS_SMMU_CB26_TCR_LPAE_2_APPS_ADDR A:0x61e3a030
y.create.l HWIO_APPS_SMMU_CB27_TCR_LPAE_2_APPS_ADDR A:0x61e3b030
y.create.l HWIO_APPS_SMMU_CB28_TCR_LPAE_2_APPS_ADDR A:0x61e3c030
y.create.l HWIO_APPS_SMMU_CB29_TCR_LPAE_2_APPS_ADDR A:0x61e3d030
y.create.l HWIO_APPS_SMMU_CB30_TCR_LPAE_2_APPS_ADDR A:0x61e3e030
y.create.l HWIO_APPS_SMMU_CB31_TCR_LPAE_2_APPS_ADDR A:0x61e3f030
y.create.l HWIO_APPS_SMMU_CB0_CONTEXTIDR_2_APPS_ADDR A:0x61e20034
y.create.l HWIO_APPS_SMMU_CB1_CONTEXTIDR_2_APPS_ADDR A:0x61e21034
y.create.l HWIO_APPS_SMMU_CB2_CONTEXTIDR_2_APPS_ADDR A:0x61e22034
y.create.l HWIO_APPS_SMMU_CB3_CONTEXTIDR_2_APPS_ADDR A:0x61e23034
y.create.l HWIO_APPS_SMMU_CB4_CONTEXTIDR_2_APPS_ADDR A:0x61e24034
y.create.l HWIO_APPS_SMMU_CB5_CONTEXTIDR_2_APPS_ADDR A:0x61e25034
y.create.l HWIO_APPS_SMMU_CB6_CONTEXTIDR_2_APPS_ADDR A:0x61e26034
y.create.l HWIO_APPS_SMMU_CB7_CONTEXTIDR_2_APPS_ADDR A:0x61e27034
y.create.l HWIO_APPS_SMMU_CB8_CONTEXTIDR_2_APPS_ADDR A:0x61e28034
y.create.l HWIO_APPS_SMMU_CB9_CONTEXTIDR_2_APPS_ADDR A:0x61e29034
y.create.l HWIO_APPS_SMMU_CB10_CONTEXTIDR_2_APPS_ADDR A:0x61e2a034
y.create.l HWIO_APPS_SMMU_CB11_CONTEXTIDR_2_APPS_ADDR A:0x61e2b034
y.create.l HWIO_APPS_SMMU_CB12_CONTEXTIDR_2_APPS_ADDR A:0x61e2c034
y.create.l HWIO_APPS_SMMU_CB13_CONTEXTIDR_2_APPS_ADDR A:0x61e2d034
y.create.l HWIO_APPS_SMMU_CB14_CONTEXTIDR_2_APPS_ADDR A:0x61e2e034
y.create.l HWIO_APPS_SMMU_CB15_CONTEXTIDR_2_APPS_ADDR A:0x61e2f034
y.create.l HWIO_APPS_SMMU_CB16_CONTEXTIDR_2_APPS_ADDR A:0x61e30034
y.create.l HWIO_APPS_SMMU_CB17_CONTEXTIDR_2_APPS_ADDR A:0x61e31034
y.create.l HWIO_APPS_SMMU_CB18_CONTEXTIDR_2_APPS_ADDR A:0x61e32034
y.create.l HWIO_APPS_SMMU_CB19_CONTEXTIDR_2_APPS_ADDR A:0x61e33034
y.create.l HWIO_APPS_SMMU_CB20_CONTEXTIDR_2_APPS_ADDR A:0x61e34034
y.create.l HWIO_APPS_SMMU_CB21_CONTEXTIDR_2_APPS_ADDR A:0x61e35034
y.create.l HWIO_APPS_SMMU_CB22_CONTEXTIDR_2_APPS_ADDR A:0x61e36034
y.create.l HWIO_APPS_SMMU_CB23_CONTEXTIDR_2_APPS_ADDR A:0x61e37034
y.create.l HWIO_APPS_SMMU_CB24_CONTEXTIDR_2_APPS_ADDR A:0x61e38034
y.create.l HWIO_APPS_SMMU_CB25_CONTEXTIDR_2_APPS_ADDR A:0x61e39034
y.create.l HWIO_APPS_SMMU_CB26_CONTEXTIDR_2_APPS_ADDR A:0x61e3a034
y.create.l HWIO_APPS_SMMU_CB27_CONTEXTIDR_2_APPS_ADDR A:0x61e3b034
y.create.l HWIO_APPS_SMMU_CB28_CONTEXTIDR_2_APPS_ADDR A:0x61e3c034
y.create.l HWIO_APPS_SMMU_CB29_CONTEXTIDR_2_APPS_ADDR A:0x61e3d034
y.create.l HWIO_APPS_SMMU_CB30_CONTEXTIDR_2_APPS_ADDR A:0x61e3e034
y.create.l HWIO_APPS_SMMU_CB31_CONTEXTIDR_2_APPS_ADDR A:0x61e3f034
y.create.l HWIO_APPS_SMMU_CB0_PRRR_MAIR0_2_APPS_ADDR A:0x61e20038
y.create.l HWIO_APPS_SMMU_CB1_PRRR_MAIR0_2_APPS_ADDR A:0x61e21038
y.create.l HWIO_APPS_SMMU_CB2_PRRR_MAIR0_2_APPS_ADDR A:0x61e22038
y.create.l HWIO_APPS_SMMU_CB3_PRRR_MAIR0_2_APPS_ADDR A:0x61e23038
y.create.l HWIO_APPS_SMMU_CB4_PRRR_MAIR0_2_APPS_ADDR A:0x61e24038
y.create.l HWIO_APPS_SMMU_CB5_PRRR_MAIR0_2_APPS_ADDR A:0x61e25038
y.create.l HWIO_APPS_SMMU_CB6_PRRR_MAIR0_2_APPS_ADDR A:0x61e26038
y.create.l HWIO_APPS_SMMU_CB7_PRRR_MAIR0_2_APPS_ADDR A:0x61e27038
y.create.l HWIO_APPS_SMMU_CB8_PRRR_MAIR0_2_APPS_ADDR A:0x61e28038
y.create.l HWIO_APPS_SMMU_CB9_PRRR_MAIR0_2_APPS_ADDR A:0x61e29038
y.create.l HWIO_APPS_SMMU_CB10_PRRR_MAIR0_2_APPS_ADDR A:0x61e2a038
y.create.l HWIO_APPS_SMMU_CB11_PRRR_MAIR0_2_APPS_ADDR A:0x61e2b038
y.create.l HWIO_APPS_SMMU_CB12_PRRR_MAIR0_2_APPS_ADDR A:0x61e2c038
y.create.l HWIO_APPS_SMMU_CB13_PRRR_MAIR0_2_APPS_ADDR A:0x61e2d038
y.create.l HWIO_APPS_SMMU_CB14_PRRR_MAIR0_2_APPS_ADDR A:0x61e2e038
y.create.l HWIO_APPS_SMMU_CB15_PRRR_MAIR0_2_APPS_ADDR A:0x61e2f038
y.create.l HWIO_APPS_SMMU_CB16_PRRR_MAIR0_2_APPS_ADDR A:0x61e30038
y.create.l HWIO_APPS_SMMU_CB17_PRRR_MAIR0_2_APPS_ADDR A:0x61e31038
y.create.l HWIO_APPS_SMMU_CB18_PRRR_MAIR0_2_APPS_ADDR A:0x61e32038
y.create.l HWIO_APPS_SMMU_CB19_PRRR_MAIR0_2_APPS_ADDR A:0x61e33038
y.create.l HWIO_APPS_SMMU_CB20_PRRR_MAIR0_2_APPS_ADDR A:0x61e34038
y.create.l HWIO_APPS_SMMU_CB21_PRRR_MAIR0_2_APPS_ADDR A:0x61e35038
y.create.l HWIO_APPS_SMMU_CB22_PRRR_MAIR0_2_APPS_ADDR A:0x61e36038
y.create.l HWIO_APPS_SMMU_CB23_PRRR_MAIR0_2_APPS_ADDR A:0x61e37038
y.create.l HWIO_APPS_SMMU_CB24_PRRR_MAIR0_2_APPS_ADDR A:0x61e38038
y.create.l HWIO_APPS_SMMU_CB25_PRRR_MAIR0_2_APPS_ADDR A:0x61e39038
y.create.l HWIO_APPS_SMMU_CB26_PRRR_MAIR0_2_APPS_ADDR A:0x61e3a038
y.create.l HWIO_APPS_SMMU_CB27_PRRR_MAIR0_2_APPS_ADDR A:0x61e3b038
y.create.l HWIO_APPS_SMMU_CB28_PRRR_MAIR0_2_APPS_ADDR A:0x61e3c038
y.create.l HWIO_APPS_SMMU_CB29_PRRR_MAIR0_2_APPS_ADDR A:0x61e3d038
y.create.l HWIO_APPS_SMMU_CB30_PRRR_MAIR0_2_APPS_ADDR A:0x61e3e038
y.create.l HWIO_APPS_SMMU_CB31_PRRR_MAIR0_2_APPS_ADDR A:0x61e3f038
y.create.l HWIO_APPS_SMMU_CB0_NMRR_MAIR1_2_APPS_ADDR A:0x61e2003c
y.create.l HWIO_APPS_SMMU_CB1_NMRR_MAIR1_2_APPS_ADDR A:0x61e2103c
y.create.l HWIO_APPS_SMMU_CB2_NMRR_MAIR1_2_APPS_ADDR A:0x61e2203c
y.create.l HWIO_APPS_SMMU_CB3_NMRR_MAIR1_2_APPS_ADDR A:0x61e2303c
y.create.l HWIO_APPS_SMMU_CB4_NMRR_MAIR1_2_APPS_ADDR A:0x61e2403c
y.create.l HWIO_APPS_SMMU_CB5_NMRR_MAIR1_2_APPS_ADDR A:0x61e2503c
y.create.l HWIO_APPS_SMMU_CB6_NMRR_MAIR1_2_APPS_ADDR A:0x61e2603c
y.create.l HWIO_APPS_SMMU_CB7_NMRR_MAIR1_2_APPS_ADDR A:0x61e2703c
y.create.l HWIO_APPS_SMMU_CB8_NMRR_MAIR1_2_APPS_ADDR A:0x61e2803c
y.create.l HWIO_APPS_SMMU_CB9_NMRR_MAIR1_2_APPS_ADDR A:0x61e2903c
y.create.l HWIO_APPS_SMMU_CB10_NMRR_MAIR1_2_APPS_ADDR A:0x61e2a03c
y.create.l HWIO_APPS_SMMU_CB11_NMRR_MAIR1_2_APPS_ADDR A:0x61e2b03c
y.create.l HWIO_APPS_SMMU_CB12_NMRR_MAIR1_2_APPS_ADDR A:0x61e2c03c
y.create.l HWIO_APPS_SMMU_CB13_NMRR_MAIR1_2_APPS_ADDR A:0x61e2d03c
y.create.l HWIO_APPS_SMMU_CB14_NMRR_MAIR1_2_APPS_ADDR A:0x61e2e03c
y.create.l HWIO_APPS_SMMU_CB15_NMRR_MAIR1_2_APPS_ADDR A:0x61e2f03c
y.create.l HWIO_APPS_SMMU_CB16_NMRR_MAIR1_2_APPS_ADDR A:0x61e3003c
y.create.l HWIO_APPS_SMMU_CB17_NMRR_MAIR1_2_APPS_ADDR A:0x61e3103c
y.create.l HWIO_APPS_SMMU_CB18_NMRR_MAIR1_2_APPS_ADDR A:0x61e3203c
y.create.l HWIO_APPS_SMMU_CB19_NMRR_MAIR1_2_APPS_ADDR A:0x61e3303c
y.create.l HWIO_APPS_SMMU_CB20_NMRR_MAIR1_2_APPS_ADDR A:0x61e3403c
y.create.l HWIO_APPS_SMMU_CB21_NMRR_MAIR1_2_APPS_ADDR A:0x61e3503c
y.create.l HWIO_APPS_SMMU_CB22_NMRR_MAIR1_2_APPS_ADDR A:0x61e3603c
y.create.l HWIO_APPS_SMMU_CB23_NMRR_MAIR1_2_APPS_ADDR A:0x61e3703c
y.create.l HWIO_APPS_SMMU_CB24_NMRR_MAIR1_2_APPS_ADDR A:0x61e3803c
y.create.l HWIO_APPS_SMMU_CB25_NMRR_MAIR1_2_APPS_ADDR A:0x61e3903c
y.create.l HWIO_APPS_SMMU_CB26_NMRR_MAIR1_2_APPS_ADDR A:0x61e3a03c
y.create.l HWIO_APPS_SMMU_CB27_NMRR_MAIR1_2_APPS_ADDR A:0x61e3b03c
y.create.l HWIO_APPS_SMMU_CB28_NMRR_MAIR1_2_APPS_ADDR A:0x61e3c03c
y.create.l HWIO_APPS_SMMU_CB29_NMRR_MAIR1_2_APPS_ADDR A:0x61e3d03c
y.create.l HWIO_APPS_SMMU_CB30_NMRR_MAIR1_2_APPS_ADDR A:0x61e3e03c
y.create.l HWIO_APPS_SMMU_CB31_NMRR_MAIR1_2_APPS_ADDR A:0x61e3f03c
y.create.l HWIO_APPS_SMMU_CB0_FSR_2_APPS_ADDR A:0x61e20058
y.create.l HWIO_APPS_SMMU_CB1_FSR_2_APPS_ADDR A:0x61e21058
y.create.l HWIO_APPS_SMMU_CB2_FSR_2_APPS_ADDR A:0x61e22058
y.create.l HWIO_APPS_SMMU_CB3_FSR_2_APPS_ADDR A:0x61e23058
y.create.l HWIO_APPS_SMMU_CB4_FSR_2_APPS_ADDR A:0x61e24058
y.create.l HWIO_APPS_SMMU_CB5_FSR_2_APPS_ADDR A:0x61e25058
y.create.l HWIO_APPS_SMMU_CB6_FSR_2_APPS_ADDR A:0x61e26058
y.create.l HWIO_APPS_SMMU_CB7_FSR_2_APPS_ADDR A:0x61e27058
y.create.l HWIO_APPS_SMMU_CB8_FSR_2_APPS_ADDR A:0x61e28058
y.create.l HWIO_APPS_SMMU_CB9_FSR_2_APPS_ADDR A:0x61e29058
y.create.l HWIO_APPS_SMMU_CB10_FSR_2_APPS_ADDR A:0x61e2a058
y.create.l HWIO_APPS_SMMU_CB11_FSR_2_APPS_ADDR A:0x61e2b058
y.create.l HWIO_APPS_SMMU_CB12_FSR_2_APPS_ADDR A:0x61e2c058
y.create.l HWIO_APPS_SMMU_CB13_FSR_2_APPS_ADDR A:0x61e2d058
y.create.l HWIO_APPS_SMMU_CB14_FSR_2_APPS_ADDR A:0x61e2e058
y.create.l HWIO_APPS_SMMU_CB15_FSR_2_APPS_ADDR A:0x61e2f058
y.create.l HWIO_APPS_SMMU_CB16_FSR_2_APPS_ADDR A:0x61e30058
y.create.l HWIO_APPS_SMMU_CB17_FSR_2_APPS_ADDR A:0x61e31058
y.create.l HWIO_APPS_SMMU_CB18_FSR_2_APPS_ADDR A:0x61e32058
y.create.l HWIO_APPS_SMMU_CB19_FSR_2_APPS_ADDR A:0x61e33058
y.create.l HWIO_APPS_SMMU_CB20_FSR_2_APPS_ADDR A:0x61e34058
y.create.l HWIO_APPS_SMMU_CB21_FSR_2_APPS_ADDR A:0x61e35058
y.create.l HWIO_APPS_SMMU_CB22_FSR_2_APPS_ADDR A:0x61e36058
y.create.l HWIO_APPS_SMMU_CB23_FSR_2_APPS_ADDR A:0x61e37058
y.create.l HWIO_APPS_SMMU_CB24_FSR_2_APPS_ADDR A:0x61e38058
y.create.l HWIO_APPS_SMMU_CB25_FSR_2_APPS_ADDR A:0x61e39058
y.create.l HWIO_APPS_SMMU_CB26_FSR_2_APPS_ADDR A:0x61e3a058
y.create.l HWIO_APPS_SMMU_CB27_FSR_2_APPS_ADDR A:0x61e3b058
y.create.l HWIO_APPS_SMMU_CB28_FSR_2_APPS_ADDR A:0x61e3c058
y.create.l HWIO_APPS_SMMU_CB29_FSR_2_APPS_ADDR A:0x61e3d058
y.create.l HWIO_APPS_SMMU_CB30_FSR_2_APPS_ADDR A:0x61e3e058
y.create.l HWIO_APPS_SMMU_CB31_FSR_2_APPS_ADDR A:0x61e3f058
y.create.l HWIO_APPS_SMMU_CB0_FSRRESTORE_2_APPS_ADDR A:0x61e2005c
y.create.l HWIO_APPS_SMMU_CB1_FSRRESTORE_2_APPS_ADDR A:0x61e2105c
y.create.l HWIO_APPS_SMMU_CB2_FSRRESTORE_2_APPS_ADDR A:0x61e2205c
y.create.l HWIO_APPS_SMMU_CB3_FSRRESTORE_2_APPS_ADDR A:0x61e2305c
y.create.l HWIO_APPS_SMMU_CB4_FSRRESTORE_2_APPS_ADDR A:0x61e2405c
y.create.l HWIO_APPS_SMMU_CB5_FSRRESTORE_2_APPS_ADDR A:0x61e2505c
y.create.l HWIO_APPS_SMMU_CB6_FSRRESTORE_2_APPS_ADDR A:0x61e2605c
y.create.l HWIO_APPS_SMMU_CB7_FSRRESTORE_2_APPS_ADDR A:0x61e2705c
y.create.l HWIO_APPS_SMMU_CB8_FSRRESTORE_2_APPS_ADDR A:0x61e2805c
y.create.l HWIO_APPS_SMMU_CB9_FSRRESTORE_2_APPS_ADDR A:0x61e2905c
y.create.l HWIO_APPS_SMMU_CB10_FSRRESTORE_2_APPS_ADDR A:0x61e2a05c
y.create.l HWIO_APPS_SMMU_CB11_FSRRESTORE_2_APPS_ADDR A:0x61e2b05c
y.create.l HWIO_APPS_SMMU_CB12_FSRRESTORE_2_APPS_ADDR A:0x61e2c05c
y.create.l HWIO_APPS_SMMU_CB13_FSRRESTORE_2_APPS_ADDR A:0x61e2d05c
y.create.l HWIO_APPS_SMMU_CB14_FSRRESTORE_2_APPS_ADDR A:0x61e2e05c
y.create.l HWIO_APPS_SMMU_CB15_FSRRESTORE_2_APPS_ADDR A:0x61e2f05c
y.create.l HWIO_APPS_SMMU_CB16_FSRRESTORE_2_APPS_ADDR A:0x61e3005c
y.create.l HWIO_APPS_SMMU_CB17_FSRRESTORE_2_APPS_ADDR A:0x61e3105c
y.create.l HWIO_APPS_SMMU_CB18_FSRRESTORE_2_APPS_ADDR A:0x61e3205c
y.create.l HWIO_APPS_SMMU_CB19_FSRRESTORE_2_APPS_ADDR A:0x61e3305c
y.create.l HWIO_APPS_SMMU_CB20_FSRRESTORE_2_APPS_ADDR A:0x61e3405c
y.create.l HWIO_APPS_SMMU_CB21_FSRRESTORE_2_APPS_ADDR A:0x61e3505c
y.create.l HWIO_APPS_SMMU_CB22_FSRRESTORE_2_APPS_ADDR A:0x61e3605c
y.create.l HWIO_APPS_SMMU_CB23_FSRRESTORE_2_APPS_ADDR A:0x61e3705c
y.create.l HWIO_APPS_SMMU_CB24_FSRRESTORE_2_APPS_ADDR A:0x61e3805c
y.create.l HWIO_APPS_SMMU_CB25_FSRRESTORE_2_APPS_ADDR A:0x61e3905c
y.create.l HWIO_APPS_SMMU_CB26_FSRRESTORE_2_APPS_ADDR A:0x61e3a05c
y.create.l HWIO_APPS_SMMU_CB27_FSRRESTORE_2_APPS_ADDR A:0x61e3b05c
y.create.l HWIO_APPS_SMMU_CB28_FSRRESTORE_2_APPS_ADDR A:0x61e3c05c
y.create.l HWIO_APPS_SMMU_CB29_FSRRESTORE_2_APPS_ADDR A:0x61e3d05c
y.create.l HWIO_APPS_SMMU_CB30_FSRRESTORE_2_APPS_ADDR A:0x61e3e05c
y.create.l HWIO_APPS_SMMU_CB31_FSRRESTORE_2_APPS_ADDR A:0x61e3f05c
y.create.l HWIO_APPS_SMMU_CB0_FAR_LOW_2_APPS_ADDR A:0x61e20060
y.create.l HWIO_APPS_SMMU_CB1_FAR_LOW_2_APPS_ADDR A:0x61e21060
y.create.l HWIO_APPS_SMMU_CB2_FAR_LOW_2_APPS_ADDR A:0x61e22060
y.create.l HWIO_APPS_SMMU_CB3_FAR_LOW_2_APPS_ADDR A:0x61e23060
y.create.l HWIO_APPS_SMMU_CB4_FAR_LOW_2_APPS_ADDR A:0x61e24060
y.create.l HWIO_APPS_SMMU_CB5_FAR_LOW_2_APPS_ADDR A:0x61e25060
y.create.l HWIO_APPS_SMMU_CB6_FAR_LOW_2_APPS_ADDR A:0x61e26060
y.create.l HWIO_APPS_SMMU_CB7_FAR_LOW_2_APPS_ADDR A:0x61e27060
y.create.l HWIO_APPS_SMMU_CB8_FAR_LOW_2_APPS_ADDR A:0x61e28060
y.create.l HWIO_APPS_SMMU_CB9_FAR_LOW_2_APPS_ADDR A:0x61e29060
y.create.l HWIO_APPS_SMMU_CB10_FAR_LOW_2_APPS_ADDR A:0x61e2a060
y.create.l HWIO_APPS_SMMU_CB11_FAR_LOW_2_APPS_ADDR A:0x61e2b060
y.create.l HWIO_APPS_SMMU_CB12_FAR_LOW_2_APPS_ADDR A:0x61e2c060
y.create.l HWIO_APPS_SMMU_CB13_FAR_LOW_2_APPS_ADDR A:0x61e2d060
y.create.l HWIO_APPS_SMMU_CB14_FAR_LOW_2_APPS_ADDR A:0x61e2e060
y.create.l HWIO_APPS_SMMU_CB15_FAR_LOW_2_APPS_ADDR A:0x61e2f060
y.create.l HWIO_APPS_SMMU_CB16_FAR_LOW_2_APPS_ADDR A:0x61e30060
y.create.l HWIO_APPS_SMMU_CB17_FAR_LOW_2_APPS_ADDR A:0x61e31060
y.create.l HWIO_APPS_SMMU_CB18_FAR_LOW_2_APPS_ADDR A:0x61e32060
y.create.l HWIO_APPS_SMMU_CB19_FAR_LOW_2_APPS_ADDR A:0x61e33060
y.create.l HWIO_APPS_SMMU_CB20_FAR_LOW_2_APPS_ADDR A:0x61e34060
y.create.l HWIO_APPS_SMMU_CB21_FAR_LOW_2_APPS_ADDR A:0x61e35060
y.create.l HWIO_APPS_SMMU_CB22_FAR_LOW_2_APPS_ADDR A:0x61e36060
y.create.l HWIO_APPS_SMMU_CB23_FAR_LOW_2_APPS_ADDR A:0x61e37060
y.create.l HWIO_APPS_SMMU_CB24_FAR_LOW_2_APPS_ADDR A:0x61e38060
y.create.l HWIO_APPS_SMMU_CB25_FAR_LOW_2_APPS_ADDR A:0x61e39060
y.create.l HWIO_APPS_SMMU_CB26_FAR_LOW_2_APPS_ADDR A:0x61e3a060
y.create.l HWIO_APPS_SMMU_CB27_FAR_LOW_2_APPS_ADDR A:0x61e3b060
y.create.l HWIO_APPS_SMMU_CB28_FAR_LOW_2_APPS_ADDR A:0x61e3c060
y.create.l HWIO_APPS_SMMU_CB29_FAR_LOW_2_APPS_ADDR A:0x61e3d060
y.create.l HWIO_APPS_SMMU_CB30_FAR_LOW_2_APPS_ADDR A:0x61e3e060
y.create.l HWIO_APPS_SMMU_CB31_FAR_LOW_2_APPS_ADDR A:0x61e3f060
y.create.l HWIO_APPS_SMMU_CB0_FAR_HIGH_2_APPS_ADDR A:0x61e20064
y.create.l HWIO_APPS_SMMU_CB1_FAR_HIGH_2_APPS_ADDR A:0x61e21064
y.create.l HWIO_APPS_SMMU_CB2_FAR_HIGH_2_APPS_ADDR A:0x61e22064
y.create.l HWIO_APPS_SMMU_CB3_FAR_HIGH_2_APPS_ADDR A:0x61e23064
y.create.l HWIO_APPS_SMMU_CB4_FAR_HIGH_2_APPS_ADDR A:0x61e24064
y.create.l HWIO_APPS_SMMU_CB5_FAR_HIGH_2_APPS_ADDR A:0x61e25064
y.create.l HWIO_APPS_SMMU_CB6_FAR_HIGH_2_APPS_ADDR A:0x61e26064
y.create.l HWIO_APPS_SMMU_CB7_FAR_HIGH_2_APPS_ADDR A:0x61e27064
y.create.l HWIO_APPS_SMMU_CB8_FAR_HIGH_2_APPS_ADDR A:0x61e28064
y.create.l HWIO_APPS_SMMU_CB9_FAR_HIGH_2_APPS_ADDR A:0x61e29064
y.create.l HWIO_APPS_SMMU_CB10_FAR_HIGH_2_APPS_ADDR A:0x61e2a064
y.create.l HWIO_APPS_SMMU_CB11_FAR_HIGH_2_APPS_ADDR A:0x61e2b064
y.create.l HWIO_APPS_SMMU_CB12_FAR_HIGH_2_APPS_ADDR A:0x61e2c064
y.create.l HWIO_APPS_SMMU_CB13_FAR_HIGH_2_APPS_ADDR A:0x61e2d064
y.create.l HWIO_APPS_SMMU_CB14_FAR_HIGH_2_APPS_ADDR A:0x61e2e064
y.create.l HWIO_APPS_SMMU_CB15_FAR_HIGH_2_APPS_ADDR A:0x61e2f064
y.create.l HWIO_APPS_SMMU_CB16_FAR_HIGH_2_APPS_ADDR A:0x61e30064
y.create.l HWIO_APPS_SMMU_CB17_FAR_HIGH_2_APPS_ADDR A:0x61e31064
y.create.l HWIO_APPS_SMMU_CB18_FAR_HIGH_2_APPS_ADDR A:0x61e32064
y.create.l HWIO_APPS_SMMU_CB19_FAR_HIGH_2_APPS_ADDR A:0x61e33064
y.create.l HWIO_APPS_SMMU_CB20_FAR_HIGH_2_APPS_ADDR A:0x61e34064
y.create.l HWIO_APPS_SMMU_CB21_FAR_HIGH_2_APPS_ADDR A:0x61e35064
y.create.l HWIO_APPS_SMMU_CB22_FAR_HIGH_2_APPS_ADDR A:0x61e36064
y.create.l HWIO_APPS_SMMU_CB23_FAR_HIGH_2_APPS_ADDR A:0x61e37064
y.create.l HWIO_APPS_SMMU_CB24_FAR_HIGH_2_APPS_ADDR A:0x61e38064
y.create.l HWIO_APPS_SMMU_CB25_FAR_HIGH_2_APPS_ADDR A:0x61e39064
y.create.l HWIO_APPS_SMMU_CB26_FAR_HIGH_2_APPS_ADDR A:0x61e3a064
y.create.l HWIO_APPS_SMMU_CB27_FAR_HIGH_2_APPS_ADDR A:0x61e3b064
y.create.l HWIO_APPS_SMMU_CB28_FAR_HIGH_2_APPS_ADDR A:0x61e3c064
y.create.l HWIO_APPS_SMMU_CB29_FAR_HIGH_2_APPS_ADDR A:0x61e3d064
y.create.l HWIO_APPS_SMMU_CB30_FAR_HIGH_2_APPS_ADDR A:0x61e3e064
y.create.l HWIO_APPS_SMMU_CB31_FAR_HIGH_2_APPS_ADDR A:0x61e3f064
y.create.l HWIO_APPS_SMMU_CB0_FSYNR0_2_APPS_ADDR A:0x61e20068
y.create.l HWIO_APPS_SMMU_CB1_FSYNR0_2_APPS_ADDR A:0x61e21068
y.create.l HWIO_APPS_SMMU_CB2_FSYNR0_2_APPS_ADDR A:0x61e22068
y.create.l HWIO_APPS_SMMU_CB3_FSYNR0_2_APPS_ADDR A:0x61e23068
y.create.l HWIO_APPS_SMMU_CB4_FSYNR0_2_APPS_ADDR A:0x61e24068
y.create.l HWIO_APPS_SMMU_CB5_FSYNR0_2_APPS_ADDR A:0x61e25068
y.create.l HWIO_APPS_SMMU_CB6_FSYNR0_2_APPS_ADDR A:0x61e26068
y.create.l HWIO_APPS_SMMU_CB7_FSYNR0_2_APPS_ADDR A:0x61e27068
y.create.l HWIO_APPS_SMMU_CB8_FSYNR0_2_APPS_ADDR A:0x61e28068
y.create.l HWIO_APPS_SMMU_CB9_FSYNR0_2_APPS_ADDR A:0x61e29068
y.create.l HWIO_APPS_SMMU_CB10_FSYNR0_2_APPS_ADDR A:0x61e2a068
y.create.l HWIO_APPS_SMMU_CB11_FSYNR0_2_APPS_ADDR A:0x61e2b068
y.create.l HWIO_APPS_SMMU_CB12_FSYNR0_2_APPS_ADDR A:0x61e2c068
y.create.l HWIO_APPS_SMMU_CB13_FSYNR0_2_APPS_ADDR A:0x61e2d068
y.create.l HWIO_APPS_SMMU_CB14_FSYNR0_2_APPS_ADDR A:0x61e2e068
y.create.l HWIO_APPS_SMMU_CB15_FSYNR0_2_APPS_ADDR A:0x61e2f068
y.create.l HWIO_APPS_SMMU_CB16_FSYNR0_2_APPS_ADDR A:0x61e30068
y.create.l HWIO_APPS_SMMU_CB17_FSYNR0_2_APPS_ADDR A:0x61e31068
y.create.l HWIO_APPS_SMMU_CB18_FSYNR0_2_APPS_ADDR A:0x61e32068
y.create.l HWIO_APPS_SMMU_CB19_FSYNR0_2_APPS_ADDR A:0x61e33068
y.create.l HWIO_APPS_SMMU_CB20_FSYNR0_2_APPS_ADDR A:0x61e34068
y.create.l HWIO_APPS_SMMU_CB21_FSYNR0_2_APPS_ADDR A:0x61e35068
y.create.l HWIO_APPS_SMMU_CB22_FSYNR0_2_APPS_ADDR A:0x61e36068
y.create.l HWIO_APPS_SMMU_CB23_FSYNR0_2_APPS_ADDR A:0x61e37068
y.create.l HWIO_APPS_SMMU_CB24_FSYNR0_2_APPS_ADDR A:0x61e38068
y.create.l HWIO_APPS_SMMU_CB25_FSYNR0_2_APPS_ADDR A:0x61e39068
y.create.l HWIO_APPS_SMMU_CB26_FSYNR0_2_APPS_ADDR A:0x61e3a068
y.create.l HWIO_APPS_SMMU_CB27_FSYNR0_2_APPS_ADDR A:0x61e3b068
y.create.l HWIO_APPS_SMMU_CB28_FSYNR0_2_APPS_ADDR A:0x61e3c068
y.create.l HWIO_APPS_SMMU_CB29_FSYNR0_2_APPS_ADDR A:0x61e3d068
y.create.l HWIO_APPS_SMMU_CB30_FSYNR0_2_APPS_ADDR A:0x61e3e068
y.create.l HWIO_APPS_SMMU_CB31_FSYNR0_2_APPS_ADDR A:0x61e3f068
y.create.l HWIO_APPS_SMMU_CB0_IPAFAR_LOW_2_APPS_ADDR A:0x61e20070
y.create.l HWIO_APPS_SMMU_CB1_IPAFAR_LOW_2_APPS_ADDR A:0x61e21070
y.create.l HWIO_APPS_SMMU_CB2_IPAFAR_LOW_2_APPS_ADDR A:0x61e22070
y.create.l HWIO_APPS_SMMU_CB3_IPAFAR_LOW_2_APPS_ADDR A:0x61e23070
y.create.l HWIO_APPS_SMMU_CB4_IPAFAR_LOW_2_APPS_ADDR A:0x61e24070
y.create.l HWIO_APPS_SMMU_CB5_IPAFAR_LOW_2_APPS_ADDR A:0x61e25070
y.create.l HWIO_APPS_SMMU_CB6_IPAFAR_LOW_2_APPS_ADDR A:0x61e26070
y.create.l HWIO_APPS_SMMU_CB7_IPAFAR_LOW_2_APPS_ADDR A:0x61e27070
y.create.l HWIO_APPS_SMMU_CB8_IPAFAR_LOW_2_APPS_ADDR A:0x61e28070
y.create.l HWIO_APPS_SMMU_CB9_IPAFAR_LOW_2_APPS_ADDR A:0x61e29070
y.create.l HWIO_APPS_SMMU_CB10_IPAFAR_LOW_2_APPS_ADDR A:0x61e2a070
y.create.l HWIO_APPS_SMMU_CB11_IPAFAR_LOW_2_APPS_ADDR A:0x61e2b070
y.create.l HWIO_APPS_SMMU_CB12_IPAFAR_LOW_2_APPS_ADDR A:0x61e2c070
y.create.l HWIO_APPS_SMMU_CB13_IPAFAR_LOW_2_APPS_ADDR A:0x61e2d070
y.create.l HWIO_APPS_SMMU_CB14_IPAFAR_LOW_2_APPS_ADDR A:0x61e2e070
y.create.l HWIO_APPS_SMMU_CB15_IPAFAR_LOW_2_APPS_ADDR A:0x61e2f070
y.create.l HWIO_APPS_SMMU_CB16_IPAFAR_LOW_2_APPS_ADDR A:0x61e30070
y.create.l HWIO_APPS_SMMU_CB17_IPAFAR_LOW_2_APPS_ADDR A:0x61e31070
y.create.l HWIO_APPS_SMMU_CB18_IPAFAR_LOW_2_APPS_ADDR A:0x61e32070
y.create.l HWIO_APPS_SMMU_CB19_IPAFAR_LOW_2_APPS_ADDR A:0x61e33070
y.create.l HWIO_APPS_SMMU_CB20_IPAFAR_LOW_2_APPS_ADDR A:0x61e34070
y.create.l HWIO_APPS_SMMU_CB21_IPAFAR_LOW_2_APPS_ADDR A:0x61e35070
y.create.l HWIO_APPS_SMMU_CB22_IPAFAR_LOW_2_APPS_ADDR A:0x61e36070
y.create.l HWIO_APPS_SMMU_CB23_IPAFAR_LOW_2_APPS_ADDR A:0x61e37070
y.create.l HWIO_APPS_SMMU_CB24_IPAFAR_LOW_2_APPS_ADDR A:0x61e38070
y.create.l HWIO_APPS_SMMU_CB25_IPAFAR_LOW_2_APPS_ADDR A:0x61e39070
y.create.l HWIO_APPS_SMMU_CB26_IPAFAR_LOW_2_APPS_ADDR A:0x61e3a070
y.create.l HWIO_APPS_SMMU_CB27_IPAFAR_LOW_2_APPS_ADDR A:0x61e3b070
y.create.l HWIO_APPS_SMMU_CB28_IPAFAR_LOW_2_APPS_ADDR A:0x61e3c070
y.create.l HWIO_APPS_SMMU_CB29_IPAFAR_LOW_2_APPS_ADDR A:0x61e3d070
y.create.l HWIO_APPS_SMMU_CB30_IPAFAR_LOW_2_APPS_ADDR A:0x61e3e070
y.create.l HWIO_APPS_SMMU_CB31_IPAFAR_LOW_2_APPS_ADDR A:0x61e3f070
y.create.l HWIO_APPS_SMMU_CB0_IPAFAR_HIGH_2_APPS_ADDR A:0x61e20074
y.create.l HWIO_APPS_SMMU_CB1_IPAFAR_HIGH_2_APPS_ADDR A:0x61e21074
y.create.l HWIO_APPS_SMMU_CB2_IPAFAR_HIGH_2_APPS_ADDR A:0x61e22074
y.create.l HWIO_APPS_SMMU_CB3_IPAFAR_HIGH_2_APPS_ADDR A:0x61e23074
y.create.l HWIO_APPS_SMMU_CB4_IPAFAR_HIGH_2_APPS_ADDR A:0x61e24074
y.create.l HWIO_APPS_SMMU_CB5_IPAFAR_HIGH_2_APPS_ADDR A:0x61e25074
y.create.l HWIO_APPS_SMMU_CB6_IPAFAR_HIGH_2_APPS_ADDR A:0x61e26074
y.create.l HWIO_APPS_SMMU_CB7_IPAFAR_HIGH_2_APPS_ADDR A:0x61e27074
y.create.l HWIO_APPS_SMMU_CB8_IPAFAR_HIGH_2_APPS_ADDR A:0x61e28074
y.create.l HWIO_APPS_SMMU_CB9_IPAFAR_HIGH_2_APPS_ADDR A:0x61e29074
y.create.l HWIO_APPS_SMMU_CB10_IPAFAR_HIGH_2_APPS_ADDR A:0x61e2a074
y.create.l HWIO_APPS_SMMU_CB11_IPAFAR_HIGH_2_APPS_ADDR A:0x61e2b074
y.create.l HWIO_APPS_SMMU_CB12_IPAFAR_HIGH_2_APPS_ADDR A:0x61e2c074
y.create.l HWIO_APPS_SMMU_CB13_IPAFAR_HIGH_2_APPS_ADDR A:0x61e2d074
y.create.l HWIO_APPS_SMMU_CB14_IPAFAR_HIGH_2_APPS_ADDR A:0x61e2e074
y.create.l HWIO_APPS_SMMU_CB15_IPAFAR_HIGH_2_APPS_ADDR A:0x61e2f074
y.create.l HWIO_APPS_SMMU_CB16_IPAFAR_HIGH_2_APPS_ADDR A:0x61e30074
y.create.l HWIO_APPS_SMMU_CB17_IPAFAR_HIGH_2_APPS_ADDR A:0x61e31074
y.create.l HWIO_APPS_SMMU_CB18_IPAFAR_HIGH_2_APPS_ADDR A:0x61e32074
y.create.l HWIO_APPS_SMMU_CB19_IPAFAR_HIGH_2_APPS_ADDR A:0x61e33074
y.create.l HWIO_APPS_SMMU_CB20_IPAFAR_HIGH_2_APPS_ADDR A:0x61e34074
y.create.l HWIO_APPS_SMMU_CB21_IPAFAR_HIGH_2_APPS_ADDR A:0x61e35074
y.create.l HWIO_APPS_SMMU_CB22_IPAFAR_HIGH_2_APPS_ADDR A:0x61e36074
y.create.l HWIO_APPS_SMMU_CB23_IPAFAR_HIGH_2_APPS_ADDR A:0x61e37074
y.create.l HWIO_APPS_SMMU_CB24_IPAFAR_HIGH_2_APPS_ADDR A:0x61e38074
y.create.l HWIO_APPS_SMMU_CB25_IPAFAR_HIGH_2_APPS_ADDR A:0x61e39074
y.create.l HWIO_APPS_SMMU_CB26_IPAFAR_HIGH_2_APPS_ADDR A:0x61e3a074
y.create.l HWIO_APPS_SMMU_CB27_IPAFAR_HIGH_2_APPS_ADDR A:0x61e3b074
y.create.l HWIO_APPS_SMMU_CB28_IPAFAR_HIGH_2_APPS_ADDR A:0x61e3c074
y.create.l HWIO_APPS_SMMU_CB29_IPAFAR_HIGH_2_APPS_ADDR A:0x61e3d074
y.create.l HWIO_APPS_SMMU_CB30_IPAFAR_HIGH_2_APPS_ADDR A:0x61e3e074
y.create.l HWIO_APPS_SMMU_CB31_IPAFAR_HIGH_2_APPS_ADDR A:0x61e3f074
y.create.l HWIO_APPS_SMMU_CB0_TLBIVA_LOW_2_APPS_ADDR A:0x61e20600
y.create.l HWIO_APPS_SMMU_CB1_TLBIVA_LOW_2_APPS_ADDR A:0x61e21600
y.create.l HWIO_APPS_SMMU_CB2_TLBIVA_LOW_2_APPS_ADDR A:0x61e22600
y.create.l HWIO_APPS_SMMU_CB3_TLBIVA_LOW_2_APPS_ADDR A:0x61e23600
y.create.l HWIO_APPS_SMMU_CB4_TLBIVA_LOW_2_APPS_ADDR A:0x61e24600
y.create.l HWIO_APPS_SMMU_CB5_TLBIVA_LOW_2_APPS_ADDR A:0x61e25600
y.create.l HWIO_APPS_SMMU_CB6_TLBIVA_LOW_2_APPS_ADDR A:0x61e26600
y.create.l HWIO_APPS_SMMU_CB7_TLBIVA_LOW_2_APPS_ADDR A:0x61e27600
y.create.l HWIO_APPS_SMMU_CB8_TLBIVA_LOW_2_APPS_ADDR A:0x61e28600
y.create.l HWIO_APPS_SMMU_CB9_TLBIVA_LOW_2_APPS_ADDR A:0x61e29600
y.create.l HWIO_APPS_SMMU_CB10_TLBIVA_LOW_2_APPS_ADDR A:0x61e2a600
y.create.l HWIO_APPS_SMMU_CB11_TLBIVA_LOW_2_APPS_ADDR A:0x61e2b600
y.create.l HWIO_APPS_SMMU_CB12_TLBIVA_LOW_2_APPS_ADDR A:0x61e2c600
y.create.l HWIO_APPS_SMMU_CB13_TLBIVA_LOW_2_APPS_ADDR A:0x61e2d600
y.create.l HWIO_APPS_SMMU_CB14_TLBIVA_LOW_2_APPS_ADDR A:0x61e2e600
y.create.l HWIO_APPS_SMMU_CB15_TLBIVA_LOW_2_APPS_ADDR A:0x61e2f600
y.create.l HWIO_APPS_SMMU_CB16_TLBIVA_LOW_2_APPS_ADDR A:0x61e30600
y.create.l HWIO_APPS_SMMU_CB17_TLBIVA_LOW_2_APPS_ADDR A:0x61e31600
y.create.l HWIO_APPS_SMMU_CB18_TLBIVA_LOW_2_APPS_ADDR A:0x61e32600
y.create.l HWIO_APPS_SMMU_CB19_TLBIVA_LOW_2_APPS_ADDR A:0x61e33600
y.create.l HWIO_APPS_SMMU_CB20_TLBIVA_LOW_2_APPS_ADDR A:0x61e34600
y.create.l HWIO_APPS_SMMU_CB21_TLBIVA_LOW_2_APPS_ADDR A:0x61e35600
y.create.l HWIO_APPS_SMMU_CB22_TLBIVA_LOW_2_APPS_ADDR A:0x61e36600
y.create.l HWIO_APPS_SMMU_CB23_TLBIVA_LOW_2_APPS_ADDR A:0x61e37600
y.create.l HWIO_APPS_SMMU_CB24_TLBIVA_LOW_2_APPS_ADDR A:0x61e38600
y.create.l HWIO_APPS_SMMU_CB25_TLBIVA_LOW_2_APPS_ADDR A:0x61e39600
y.create.l HWIO_APPS_SMMU_CB26_TLBIVA_LOW_2_APPS_ADDR A:0x61e3a600
y.create.l HWIO_APPS_SMMU_CB27_TLBIVA_LOW_2_APPS_ADDR A:0x61e3b600
y.create.l HWIO_APPS_SMMU_CB28_TLBIVA_LOW_2_APPS_ADDR A:0x61e3c600
y.create.l HWIO_APPS_SMMU_CB29_TLBIVA_LOW_2_APPS_ADDR A:0x61e3d600
y.create.l HWIO_APPS_SMMU_CB30_TLBIVA_LOW_2_APPS_ADDR A:0x61e3e600
y.create.l HWIO_APPS_SMMU_CB31_TLBIVA_LOW_2_APPS_ADDR A:0x61e3f600
y.create.l HWIO_APPS_SMMU_CB0_TLBIVA_HIGH_2_APPS_ADDR A:0x61e20604
y.create.l HWIO_APPS_SMMU_CB1_TLBIVA_HIGH_2_APPS_ADDR A:0x61e21604
y.create.l HWIO_APPS_SMMU_CB2_TLBIVA_HIGH_2_APPS_ADDR A:0x61e22604
y.create.l HWIO_APPS_SMMU_CB3_TLBIVA_HIGH_2_APPS_ADDR A:0x61e23604
y.create.l HWIO_APPS_SMMU_CB4_TLBIVA_HIGH_2_APPS_ADDR A:0x61e24604
y.create.l HWIO_APPS_SMMU_CB5_TLBIVA_HIGH_2_APPS_ADDR A:0x61e25604
y.create.l HWIO_APPS_SMMU_CB6_TLBIVA_HIGH_2_APPS_ADDR A:0x61e26604
y.create.l HWIO_APPS_SMMU_CB7_TLBIVA_HIGH_2_APPS_ADDR A:0x61e27604
y.create.l HWIO_APPS_SMMU_CB8_TLBIVA_HIGH_2_APPS_ADDR A:0x61e28604
y.create.l HWIO_APPS_SMMU_CB9_TLBIVA_HIGH_2_APPS_ADDR A:0x61e29604
y.create.l HWIO_APPS_SMMU_CB10_TLBIVA_HIGH_2_APPS_ADDR A:0x61e2a604
y.create.l HWIO_APPS_SMMU_CB11_TLBIVA_HIGH_2_APPS_ADDR A:0x61e2b604
y.create.l HWIO_APPS_SMMU_CB12_TLBIVA_HIGH_2_APPS_ADDR A:0x61e2c604
y.create.l HWIO_APPS_SMMU_CB13_TLBIVA_HIGH_2_APPS_ADDR A:0x61e2d604
y.create.l HWIO_APPS_SMMU_CB14_TLBIVA_HIGH_2_APPS_ADDR A:0x61e2e604
y.create.l HWIO_APPS_SMMU_CB15_TLBIVA_HIGH_2_APPS_ADDR A:0x61e2f604
y.create.l HWIO_APPS_SMMU_CB16_TLBIVA_HIGH_2_APPS_ADDR A:0x61e30604
y.create.l HWIO_APPS_SMMU_CB17_TLBIVA_HIGH_2_APPS_ADDR A:0x61e31604
y.create.l HWIO_APPS_SMMU_CB18_TLBIVA_HIGH_2_APPS_ADDR A:0x61e32604
y.create.l HWIO_APPS_SMMU_CB19_TLBIVA_HIGH_2_APPS_ADDR A:0x61e33604
y.create.l HWIO_APPS_SMMU_CB20_TLBIVA_HIGH_2_APPS_ADDR A:0x61e34604
y.create.l HWIO_APPS_SMMU_CB21_TLBIVA_HIGH_2_APPS_ADDR A:0x61e35604
y.create.l HWIO_APPS_SMMU_CB22_TLBIVA_HIGH_2_APPS_ADDR A:0x61e36604
y.create.l HWIO_APPS_SMMU_CB23_TLBIVA_HIGH_2_APPS_ADDR A:0x61e37604
y.create.l HWIO_APPS_SMMU_CB24_TLBIVA_HIGH_2_APPS_ADDR A:0x61e38604
y.create.l HWIO_APPS_SMMU_CB25_TLBIVA_HIGH_2_APPS_ADDR A:0x61e39604
y.create.l HWIO_APPS_SMMU_CB26_TLBIVA_HIGH_2_APPS_ADDR A:0x61e3a604
y.create.l HWIO_APPS_SMMU_CB27_TLBIVA_HIGH_2_APPS_ADDR A:0x61e3b604
y.create.l HWIO_APPS_SMMU_CB28_TLBIVA_HIGH_2_APPS_ADDR A:0x61e3c604
y.create.l HWIO_APPS_SMMU_CB29_TLBIVA_HIGH_2_APPS_ADDR A:0x61e3d604
y.create.l HWIO_APPS_SMMU_CB30_TLBIVA_HIGH_2_APPS_ADDR A:0x61e3e604
y.create.l HWIO_APPS_SMMU_CB31_TLBIVA_HIGH_2_APPS_ADDR A:0x61e3f604
y.create.l HWIO_APPS_SMMU_CB0_TLBIVAA_LOW_2_APPS_ADDR A:0x61e20608
y.create.l HWIO_APPS_SMMU_CB1_TLBIVAA_LOW_2_APPS_ADDR A:0x61e21608
y.create.l HWIO_APPS_SMMU_CB2_TLBIVAA_LOW_2_APPS_ADDR A:0x61e22608
y.create.l HWIO_APPS_SMMU_CB3_TLBIVAA_LOW_2_APPS_ADDR A:0x61e23608
y.create.l HWIO_APPS_SMMU_CB4_TLBIVAA_LOW_2_APPS_ADDR A:0x61e24608
y.create.l HWIO_APPS_SMMU_CB5_TLBIVAA_LOW_2_APPS_ADDR A:0x61e25608
y.create.l HWIO_APPS_SMMU_CB6_TLBIVAA_LOW_2_APPS_ADDR A:0x61e26608
y.create.l HWIO_APPS_SMMU_CB7_TLBIVAA_LOW_2_APPS_ADDR A:0x61e27608
y.create.l HWIO_APPS_SMMU_CB8_TLBIVAA_LOW_2_APPS_ADDR A:0x61e28608
y.create.l HWIO_APPS_SMMU_CB9_TLBIVAA_LOW_2_APPS_ADDR A:0x61e29608
y.create.l HWIO_APPS_SMMU_CB10_TLBIVAA_LOW_2_APPS_ADDR A:0x61e2a608
y.create.l HWIO_APPS_SMMU_CB11_TLBIVAA_LOW_2_APPS_ADDR A:0x61e2b608
y.create.l HWIO_APPS_SMMU_CB12_TLBIVAA_LOW_2_APPS_ADDR A:0x61e2c608
y.create.l HWIO_APPS_SMMU_CB13_TLBIVAA_LOW_2_APPS_ADDR A:0x61e2d608
y.create.l HWIO_APPS_SMMU_CB14_TLBIVAA_LOW_2_APPS_ADDR A:0x61e2e608
y.create.l HWIO_APPS_SMMU_CB15_TLBIVAA_LOW_2_APPS_ADDR A:0x61e2f608
y.create.l HWIO_APPS_SMMU_CB16_TLBIVAA_LOW_2_APPS_ADDR A:0x61e30608
y.create.l HWIO_APPS_SMMU_CB17_TLBIVAA_LOW_2_APPS_ADDR A:0x61e31608
y.create.l HWIO_APPS_SMMU_CB18_TLBIVAA_LOW_2_APPS_ADDR A:0x61e32608
y.create.l HWIO_APPS_SMMU_CB19_TLBIVAA_LOW_2_APPS_ADDR A:0x61e33608
y.create.l HWIO_APPS_SMMU_CB20_TLBIVAA_LOW_2_APPS_ADDR A:0x61e34608
y.create.l HWIO_APPS_SMMU_CB21_TLBIVAA_LOW_2_APPS_ADDR A:0x61e35608
y.create.l HWIO_APPS_SMMU_CB22_TLBIVAA_LOW_2_APPS_ADDR A:0x61e36608
y.create.l HWIO_APPS_SMMU_CB23_TLBIVAA_LOW_2_APPS_ADDR A:0x61e37608
y.create.l HWIO_APPS_SMMU_CB24_TLBIVAA_LOW_2_APPS_ADDR A:0x61e38608
y.create.l HWIO_APPS_SMMU_CB25_TLBIVAA_LOW_2_APPS_ADDR A:0x61e39608
y.create.l HWIO_APPS_SMMU_CB26_TLBIVAA_LOW_2_APPS_ADDR A:0x61e3a608
y.create.l HWIO_APPS_SMMU_CB27_TLBIVAA_LOW_2_APPS_ADDR A:0x61e3b608
y.create.l HWIO_APPS_SMMU_CB28_TLBIVAA_LOW_2_APPS_ADDR A:0x61e3c608
y.create.l HWIO_APPS_SMMU_CB29_TLBIVAA_LOW_2_APPS_ADDR A:0x61e3d608
y.create.l HWIO_APPS_SMMU_CB30_TLBIVAA_LOW_2_APPS_ADDR A:0x61e3e608
y.create.l HWIO_APPS_SMMU_CB31_TLBIVAA_LOW_2_APPS_ADDR A:0x61e3f608
y.create.l HWIO_APPS_SMMU_CB0_TLBIVAA_HIGH_2_APPS_ADDR A:0x61e2060c
y.create.l HWIO_APPS_SMMU_CB1_TLBIVAA_HIGH_2_APPS_ADDR A:0x61e2160c
y.create.l HWIO_APPS_SMMU_CB2_TLBIVAA_HIGH_2_APPS_ADDR A:0x61e2260c
y.create.l HWIO_APPS_SMMU_CB3_TLBIVAA_HIGH_2_APPS_ADDR A:0x61e2360c
y.create.l HWIO_APPS_SMMU_CB4_TLBIVAA_HIGH_2_APPS_ADDR A:0x61e2460c
y.create.l HWIO_APPS_SMMU_CB5_TLBIVAA_HIGH_2_APPS_ADDR A:0x61e2560c
y.create.l HWIO_APPS_SMMU_CB6_TLBIVAA_HIGH_2_APPS_ADDR A:0x61e2660c
y.create.l HWIO_APPS_SMMU_CB7_TLBIVAA_HIGH_2_APPS_ADDR A:0x61e2760c
y.create.l HWIO_APPS_SMMU_CB8_TLBIVAA_HIGH_2_APPS_ADDR A:0x61e2860c
y.create.l HWIO_APPS_SMMU_CB9_TLBIVAA_HIGH_2_APPS_ADDR A:0x61e2960c
y.create.l HWIO_APPS_SMMU_CB10_TLBIVAA_HIGH_2_APPS_ADDR A:0x61e2a60c
y.create.l HWIO_APPS_SMMU_CB11_TLBIVAA_HIGH_2_APPS_ADDR A:0x61e2b60c
y.create.l HWIO_APPS_SMMU_CB12_TLBIVAA_HIGH_2_APPS_ADDR A:0x61e2c60c
y.create.l HWIO_APPS_SMMU_CB13_TLBIVAA_HIGH_2_APPS_ADDR A:0x61e2d60c
y.create.l HWIO_APPS_SMMU_CB14_TLBIVAA_HIGH_2_APPS_ADDR A:0x61e2e60c
y.create.l HWIO_APPS_SMMU_CB15_TLBIVAA_HIGH_2_APPS_ADDR A:0x61e2f60c
y.create.l HWIO_APPS_SMMU_CB16_TLBIVAA_HIGH_2_APPS_ADDR A:0x61e3060c
y.create.l HWIO_APPS_SMMU_CB17_TLBIVAA_HIGH_2_APPS_ADDR A:0x61e3160c
y.create.l HWIO_APPS_SMMU_CB18_TLBIVAA_HIGH_2_APPS_ADDR A:0x61e3260c
y.create.l HWIO_APPS_SMMU_CB19_TLBIVAA_HIGH_2_APPS_ADDR A:0x61e3360c
y.create.l HWIO_APPS_SMMU_CB20_TLBIVAA_HIGH_2_APPS_ADDR A:0x61e3460c
y.create.l HWIO_APPS_SMMU_CB21_TLBIVAA_HIGH_2_APPS_ADDR A:0x61e3560c
y.create.l HWIO_APPS_SMMU_CB22_TLBIVAA_HIGH_2_APPS_ADDR A:0x61e3660c
y.create.l HWIO_APPS_SMMU_CB23_TLBIVAA_HIGH_2_APPS_ADDR A:0x61e3760c
y.create.l HWIO_APPS_SMMU_CB24_TLBIVAA_HIGH_2_APPS_ADDR A:0x61e3860c
y.create.l HWIO_APPS_SMMU_CB25_TLBIVAA_HIGH_2_APPS_ADDR A:0x61e3960c
y.create.l HWIO_APPS_SMMU_CB26_TLBIVAA_HIGH_2_APPS_ADDR A:0x61e3a60c
y.create.l HWIO_APPS_SMMU_CB27_TLBIVAA_HIGH_2_APPS_ADDR A:0x61e3b60c
y.create.l HWIO_APPS_SMMU_CB28_TLBIVAA_HIGH_2_APPS_ADDR A:0x61e3c60c
y.create.l HWIO_APPS_SMMU_CB29_TLBIVAA_HIGH_2_APPS_ADDR A:0x61e3d60c
y.create.l HWIO_APPS_SMMU_CB30_TLBIVAA_HIGH_2_APPS_ADDR A:0x61e3e60c
y.create.l HWIO_APPS_SMMU_CB31_TLBIVAA_HIGH_2_APPS_ADDR A:0x61e3f60c
y.create.l HWIO_APPS_SMMU_CB0_TLBIASID_2_APPS_ADDR A:0x61e20610
y.create.l HWIO_APPS_SMMU_CB1_TLBIASID_2_APPS_ADDR A:0x61e21610
y.create.l HWIO_APPS_SMMU_CB2_TLBIASID_2_APPS_ADDR A:0x61e22610
y.create.l HWIO_APPS_SMMU_CB3_TLBIASID_2_APPS_ADDR A:0x61e23610
y.create.l HWIO_APPS_SMMU_CB4_TLBIASID_2_APPS_ADDR A:0x61e24610
y.create.l HWIO_APPS_SMMU_CB5_TLBIASID_2_APPS_ADDR A:0x61e25610
y.create.l HWIO_APPS_SMMU_CB6_TLBIASID_2_APPS_ADDR A:0x61e26610
y.create.l HWIO_APPS_SMMU_CB7_TLBIASID_2_APPS_ADDR A:0x61e27610
y.create.l HWIO_APPS_SMMU_CB8_TLBIASID_2_APPS_ADDR A:0x61e28610
y.create.l HWIO_APPS_SMMU_CB9_TLBIASID_2_APPS_ADDR A:0x61e29610
y.create.l HWIO_APPS_SMMU_CB10_TLBIASID_2_APPS_ADDR A:0x61e2a610
y.create.l HWIO_APPS_SMMU_CB11_TLBIASID_2_APPS_ADDR A:0x61e2b610
y.create.l HWIO_APPS_SMMU_CB12_TLBIASID_2_APPS_ADDR A:0x61e2c610
y.create.l HWIO_APPS_SMMU_CB13_TLBIASID_2_APPS_ADDR A:0x61e2d610
y.create.l HWIO_APPS_SMMU_CB14_TLBIASID_2_APPS_ADDR A:0x61e2e610
y.create.l HWIO_APPS_SMMU_CB15_TLBIASID_2_APPS_ADDR A:0x61e2f610
y.create.l HWIO_APPS_SMMU_CB16_TLBIASID_2_APPS_ADDR A:0x61e30610
y.create.l HWIO_APPS_SMMU_CB17_TLBIASID_2_APPS_ADDR A:0x61e31610
y.create.l HWIO_APPS_SMMU_CB18_TLBIASID_2_APPS_ADDR A:0x61e32610
y.create.l HWIO_APPS_SMMU_CB19_TLBIASID_2_APPS_ADDR A:0x61e33610
y.create.l HWIO_APPS_SMMU_CB20_TLBIASID_2_APPS_ADDR A:0x61e34610
y.create.l HWIO_APPS_SMMU_CB21_TLBIASID_2_APPS_ADDR A:0x61e35610
y.create.l HWIO_APPS_SMMU_CB22_TLBIASID_2_APPS_ADDR A:0x61e36610
y.create.l HWIO_APPS_SMMU_CB23_TLBIASID_2_APPS_ADDR A:0x61e37610
y.create.l HWIO_APPS_SMMU_CB24_TLBIASID_2_APPS_ADDR A:0x61e38610
y.create.l HWIO_APPS_SMMU_CB25_TLBIASID_2_APPS_ADDR A:0x61e39610
y.create.l HWIO_APPS_SMMU_CB26_TLBIASID_2_APPS_ADDR A:0x61e3a610
y.create.l HWIO_APPS_SMMU_CB27_TLBIASID_2_APPS_ADDR A:0x61e3b610
y.create.l HWIO_APPS_SMMU_CB28_TLBIASID_2_APPS_ADDR A:0x61e3c610
y.create.l HWIO_APPS_SMMU_CB29_TLBIASID_2_APPS_ADDR A:0x61e3d610
y.create.l HWIO_APPS_SMMU_CB30_TLBIASID_2_APPS_ADDR A:0x61e3e610
y.create.l HWIO_APPS_SMMU_CB31_TLBIASID_2_APPS_ADDR A:0x61e3f610
y.create.l HWIO_APPS_SMMU_CB0_TLBIALL_2_APPS_ADDR A:0x61e20618
y.create.l HWIO_APPS_SMMU_CB1_TLBIALL_2_APPS_ADDR A:0x61e21618
y.create.l HWIO_APPS_SMMU_CB2_TLBIALL_2_APPS_ADDR A:0x61e22618
y.create.l HWIO_APPS_SMMU_CB3_TLBIALL_2_APPS_ADDR A:0x61e23618
y.create.l HWIO_APPS_SMMU_CB4_TLBIALL_2_APPS_ADDR A:0x61e24618
y.create.l HWIO_APPS_SMMU_CB5_TLBIALL_2_APPS_ADDR A:0x61e25618
y.create.l HWIO_APPS_SMMU_CB6_TLBIALL_2_APPS_ADDR A:0x61e26618
y.create.l HWIO_APPS_SMMU_CB7_TLBIALL_2_APPS_ADDR A:0x61e27618
y.create.l HWIO_APPS_SMMU_CB8_TLBIALL_2_APPS_ADDR A:0x61e28618
y.create.l HWIO_APPS_SMMU_CB9_TLBIALL_2_APPS_ADDR A:0x61e29618
y.create.l HWIO_APPS_SMMU_CB10_TLBIALL_2_APPS_ADDR A:0x61e2a618
y.create.l HWIO_APPS_SMMU_CB11_TLBIALL_2_APPS_ADDR A:0x61e2b618
y.create.l HWIO_APPS_SMMU_CB12_TLBIALL_2_APPS_ADDR A:0x61e2c618
y.create.l HWIO_APPS_SMMU_CB13_TLBIALL_2_APPS_ADDR A:0x61e2d618
y.create.l HWIO_APPS_SMMU_CB14_TLBIALL_2_APPS_ADDR A:0x61e2e618
y.create.l HWIO_APPS_SMMU_CB15_TLBIALL_2_APPS_ADDR A:0x61e2f618
y.create.l HWIO_APPS_SMMU_CB16_TLBIALL_2_APPS_ADDR A:0x61e30618
y.create.l HWIO_APPS_SMMU_CB17_TLBIALL_2_APPS_ADDR A:0x61e31618
y.create.l HWIO_APPS_SMMU_CB18_TLBIALL_2_APPS_ADDR A:0x61e32618
y.create.l HWIO_APPS_SMMU_CB19_TLBIALL_2_APPS_ADDR A:0x61e33618
y.create.l HWIO_APPS_SMMU_CB20_TLBIALL_2_APPS_ADDR A:0x61e34618
y.create.l HWIO_APPS_SMMU_CB21_TLBIALL_2_APPS_ADDR A:0x61e35618
y.create.l HWIO_APPS_SMMU_CB22_TLBIALL_2_APPS_ADDR A:0x61e36618
y.create.l HWIO_APPS_SMMU_CB23_TLBIALL_2_APPS_ADDR A:0x61e37618
y.create.l HWIO_APPS_SMMU_CB24_TLBIALL_2_APPS_ADDR A:0x61e38618
y.create.l HWIO_APPS_SMMU_CB25_TLBIALL_2_APPS_ADDR A:0x61e39618
y.create.l HWIO_APPS_SMMU_CB26_TLBIALL_2_APPS_ADDR A:0x61e3a618
y.create.l HWIO_APPS_SMMU_CB27_TLBIALL_2_APPS_ADDR A:0x61e3b618
y.create.l HWIO_APPS_SMMU_CB28_TLBIALL_2_APPS_ADDR A:0x61e3c618
y.create.l HWIO_APPS_SMMU_CB29_TLBIALL_2_APPS_ADDR A:0x61e3d618
y.create.l HWIO_APPS_SMMU_CB30_TLBIALL_2_APPS_ADDR A:0x61e3e618
y.create.l HWIO_APPS_SMMU_CB31_TLBIALL_2_APPS_ADDR A:0x61e3f618
y.create.l HWIO_APPS_SMMU_CB0_TLBIVAL_LOW_2_APPS_ADDR A:0x61e20620
y.create.l HWIO_APPS_SMMU_CB1_TLBIVAL_LOW_2_APPS_ADDR A:0x61e21620
y.create.l HWIO_APPS_SMMU_CB2_TLBIVAL_LOW_2_APPS_ADDR A:0x61e22620
y.create.l HWIO_APPS_SMMU_CB3_TLBIVAL_LOW_2_APPS_ADDR A:0x61e23620
y.create.l HWIO_APPS_SMMU_CB4_TLBIVAL_LOW_2_APPS_ADDR A:0x61e24620
y.create.l HWIO_APPS_SMMU_CB5_TLBIVAL_LOW_2_APPS_ADDR A:0x61e25620
y.create.l HWIO_APPS_SMMU_CB6_TLBIVAL_LOW_2_APPS_ADDR A:0x61e26620
y.create.l HWIO_APPS_SMMU_CB7_TLBIVAL_LOW_2_APPS_ADDR A:0x61e27620
y.create.l HWIO_APPS_SMMU_CB8_TLBIVAL_LOW_2_APPS_ADDR A:0x61e28620
y.create.l HWIO_APPS_SMMU_CB9_TLBIVAL_LOW_2_APPS_ADDR A:0x61e29620
y.create.l HWIO_APPS_SMMU_CB10_TLBIVAL_LOW_2_APPS_ADDR A:0x61e2a620
y.create.l HWIO_APPS_SMMU_CB11_TLBIVAL_LOW_2_APPS_ADDR A:0x61e2b620
y.create.l HWIO_APPS_SMMU_CB12_TLBIVAL_LOW_2_APPS_ADDR A:0x61e2c620
y.create.l HWIO_APPS_SMMU_CB13_TLBIVAL_LOW_2_APPS_ADDR A:0x61e2d620
y.create.l HWIO_APPS_SMMU_CB14_TLBIVAL_LOW_2_APPS_ADDR A:0x61e2e620
y.create.l HWIO_APPS_SMMU_CB15_TLBIVAL_LOW_2_APPS_ADDR A:0x61e2f620
y.create.l HWIO_APPS_SMMU_CB16_TLBIVAL_LOW_2_APPS_ADDR A:0x61e30620
y.create.l HWIO_APPS_SMMU_CB17_TLBIVAL_LOW_2_APPS_ADDR A:0x61e31620
y.create.l HWIO_APPS_SMMU_CB18_TLBIVAL_LOW_2_APPS_ADDR A:0x61e32620
y.create.l HWIO_APPS_SMMU_CB19_TLBIVAL_LOW_2_APPS_ADDR A:0x61e33620
y.create.l HWIO_APPS_SMMU_CB20_TLBIVAL_LOW_2_APPS_ADDR A:0x61e34620
y.create.l HWIO_APPS_SMMU_CB21_TLBIVAL_LOW_2_APPS_ADDR A:0x61e35620
y.create.l HWIO_APPS_SMMU_CB22_TLBIVAL_LOW_2_APPS_ADDR A:0x61e36620
y.create.l HWIO_APPS_SMMU_CB23_TLBIVAL_LOW_2_APPS_ADDR A:0x61e37620
y.create.l HWIO_APPS_SMMU_CB24_TLBIVAL_LOW_2_APPS_ADDR A:0x61e38620
y.create.l HWIO_APPS_SMMU_CB25_TLBIVAL_LOW_2_APPS_ADDR A:0x61e39620
y.create.l HWIO_APPS_SMMU_CB26_TLBIVAL_LOW_2_APPS_ADDR A:0x61e3a620
y.create.l HWIO_APPS_SMMU_CB27_TLBIVAL_LOW_2_APPS_ADDR A:0x61e3b620
y.create.l HWIO_APPS_SMMU_CB28_TLBIVAL_LOW_2_APPS_ADDR A:0x61e3c620
y.create.l HWIO_APPS_SMMU_CB29_TLBIVAL_LOW_2_APPS_ADDR A:0x61e3d620
y.create.l HWIO_APPS_SMMU_CB30_TLBIVAL_LOW_2_APPS_ADDR A:0x61e3e620
y.create.l HWIO_APPS_SMMU_CB31_TLBIVAL_LOW_2_APPS_ADDR A:0x61e3f620
y.create.l HWIO_APPS_SMMU_CB0_TLBIVAL_HIGH_2_APPS_ADDR A:0x61e20624
y.create.l HWIO_APPS_SMMU_CB1_TLBIVAL_HIGH_2_APPS_ADDR A:0x61e21624
y.create.l HWIO_APPS_SMMU_CB2_TLBIVAL_HIGH_2_APPS_ADDR A:0x61e22624
y.create.l HWIO_APPS_SMMU_CB3_TLBIVAL_HIGH_2_APPS_ADDR A:0x61e23624
y.create.l HWIO_APPS_SMMU_CB4_TLBIVAL_HIGH_2_APPS_ADDR A:0x61e24624
y.create.l HWIO_APPS_SMMU_CB5_TLBIVAL_HIGH_2_APPS_ADDR A:0x61e25624
y.create.l HWIO_APPS_SMMU_CB6_TLBIVAL_HIGH_2_APPS_ADDR A:0x61e26624
y.create.l HWIO_APPS_SMMU_CB7_TLBIVAL_HIGH_2_APPS_ADDR A:0x61e27624
y.create.l HWIO_APPS_SMMU_CB8_TLBIVAL_HIGH_2_APPS_ADDR A:0x61e28624
y.create.l HWIO_APPS_SMMU_CB9_TLBIVAL_HIGH_2_APPS_ADDR A:0x61e29624
y.create.l HWIO_APPS_SMMU_CB10_TLBIVAL_HIGH_2_APPS_ADDR A:0x61e2a624
y.create.l HWIO_APPS_SMMU_CB11_TLBIVAL_HIGH_2_APPS_ADDR A:0x61e2b624
y.create.l HWIO_APPS_SMMU_CB12_TLBIVAL_HIGH_2_APPS_ADDR A:0x61e2c624
y.create.l HWIO_APPS_SMMU_CB13_TLBIVAL_HIGH_2_APPS_ADDR A:0x61e2d624
y.create.l HWIO_APPS_SMMU_CB14_TLBIVAL_HIGH_2_APPS_ADDR A:0x61e2e624
y.create.l HWIO_APPS_SMMU_CB15_TLBIVAL_HIGH_2_APPS_ADDR A:0x61e2f624
y.create.l HWIO_APPS_SMMU_CB16_TLBIVAL_HIGH_2_APPS_ADDR A:0x61e30624
y.create.l HWIO_APPS_SMMU_CB17_TLBIVAL_HIGH_2_APPS_ADDR A:0x61e31624
y.create.l HWIO_APPS_SMMU_CB18_TLBIVAL_HIGH_2_APPS_ADDR A:0x61e32624
y.create.l HWIO_APPS_SMMU_CB19_TLBIVAL_HIGH_2_APPS_ADDR A:0x61e33624
y.create.l HWIO_APPS_SMMU_CB20_TLBIVAL_HIGH_2_APPS_ADDR A:0x61e34624
y.create.l HWIO_APPS_SMMU_CB21_TLBIVAL_HIGH_2_APPS_ADDR A:0x61e35624
y.create.l HWIO_APPS_SMMU_CB22_TLBIVAL_HIGH_2_APPS_ADDR A:0x61e36624
y.create.l HWIO_APPS_SMMU_CB23_TLBIVAL_HIGH_2_APPS_ADDR A:0x61e37624
y.create.l HWIO_APPS_SMMU_CB24_TLBIVAL_HIGH_2_APPS_ADDR A:0x61e38624
y.create.l HWIO_APPS_SMMU_CB25_TLBIVAL_HIGH_2_APPS_ADDR A:0x61e39624
y.create.l HWIO_APPS_SMMU_CB26_TLBIVAL_HIGH_2_APPS_ADDR A:0x61e3a624
y.create.l HWIO_APPS_SMMU_CB27_TLBIVAL_HIGH_2_APPS_ADDR A:0x61e3b624
y.create.l HWIO_APPS_SMMU_CB28_TLBIVAL_HIGH_2_APPS_ADDR A:0x61e3c624
y.create.l HWIO_APPS_SMMU_CB29_TLBIVAL_HIGH_2_APPS_ADDR A:0x61e3d624
y.create.l HWIO_APPS_SMMU_CB30_TLBIVAL_HIGH_2_APPS_ADDR A:0x61e3e624
y.create.l HWIO_APPS_SMMU_CB31_TLBIVAL_HIGH_2_APPS_ADDR A:0x61e3f624
y.create.l HWIO_APPS_SMMU_CB0_TLBIVAAL_LOW_2_APPS_ADDR A:0x61e20628
y.create.l HWIO_APPS_SMMU_CB1_TLBIVAAL_LOW_2_APPS_ADDR A:0x61e21628
y.create.l HWIO_APPS_SMMU_CB2_TLBIVAAL_LOW_2_APPS_ADDR A:0x61e22628
y.create.l HWIO_APPS_SMMU_CB3_TLBIVAAL_LOW_2_APPS_ADDR A:0x61e23628
y.create.l HWIO_APPS_SMMU_CB4_TLBIVAAL_LOW_2_APPS_ADDR A:0x61e24628
y.create.l HWIO_APPS_SMMU_CB5_TLBIVAAL_LOW_2_APPS_ADDR A:0x61e25628
y.create.l HWIO_APPS_SMMU_CB6_TLBIVAAL_LOW_2_APPS_ADDR A:0x61e26628
y.create.l HWIO_APPS_SMMU_CB7_TLBIVAAL_LOW_2_APPS_ADDR A:0x61e27628
y.create.l HWIO_APPS_SMMU_CB8_TLBIVAAL_LOW_2_APPS_ADDR A:0x61e28628
y.create.l HWIO_APPS_SMMU_CB9_TLBIVAAL_LOW_2_APPS_ADDR A:0x61e29628
y.create.l HWIO_APPS_SMMU_CB10_TLBIVAAL_LOW_2_APPS_ADDR A:0x61e2a628
y.create.l HWIO_APPS_SMMU_CB11_TLBIVAAL_LOW_2_APPS_ADDR A:0x61e2b628
y.create.l HWIO_APPS_SMMU_CB12_TLBIVAAL_LOW_2_APPS_ADDR A:0x61e2c628
y.create.l HWIO_APPS_SMMU_CB13_TLBIVAAL_LOW_2_APPS_ADDR A:0x61e2d628
y.create.l HWIO_APPS_SMMU_CB14_TLBIVAAL_LOW_2_APPS_ADDR A:0x61e2e628
y.create.l HWIO_APPS_SMMU_CB15_TLBIVAAL_LOW_2_APPS_ADDR A:0x61e2f628
y.create.l HWIO_APPS_SMMU_CB16_TLBIVAAL_LOW_2_APPS_ADDR A:0x61e30628
y.create.l HWIO_APPS_SMMU_CB17_TLBIVAAL_LOW_2_APPS_ADDR A:0x61e31628
y.create.l HWIO_APPS_SMMU_CB18_TLBIVAAL_LOW_2_APPS_ADDR A:0x61e32628
y.create.l HWIO_APPS_SMMU_CB19_TLBIVAAL_LOW_2_APPS_ADDR A:0x61e33628
y.create.l HWIO_APPS_SMMU_CB20_TLBIVAAL_LOW_2_APPS_ADDR A:0x61e34628
y.create.l HWIO_APPS_SMMU_CB21_TLBIVAAL_LOW_2_APPS_ADDR A:0x61e35628
y.create.l HWIO_APPS_SMMU_CB22_TLBIVAAL_LOW_2_APPS_ADDR A:0x61e36628
y.create.l HWIO_APPS_SMMU_CB23_TLBIVAAL_LOW_2_APPS_ADDR A:0x61e37628
y.create.l HWIO_APPS_SMMU_CB24_TLBIVAAL_LOW_2_APPS_ADDR A:0x61e38628
y.create.l HWIO_APPS_SMMU_CB25_TLBIVAAL_LOW_2_APPS_ADDR A:0x61e39628
y.create.l HWIO_APPS_SMMU_CB26_TLBIVAAL_LOW_2_APPS_ADDR A:0x61e3a628
y.create.l HWIO_APPS_SMMU_CB27_TLBIVAAL_LOW_2_APPS_ADDR A:0x61e3b628
y.create.l HWIO_APPS_SMMU_CB28_TLBIVAAL_LOW_2_APPS_ADDR A:0x61e3c628
y.create.l HWIO_APPS_SMMU_CB29_TLBIVAAL_LOW_2_APPS_ADDR A:0x61e3d628
y.create.l HWIO_APPS_SMMU_CB30_TLBIVAAL_LOW_2_APPS_ADDR A:0x61e3e628
y.create.l HWIO_APPS_SMMU_CB31_TLBIVAAL_LOW_2_APPS_ADDR A:0x61e3f628
y.create.l HWIO_APPS_SMMU_CB0_TLBIVAAL_HIGH_2_APPS_ADDR A:0x61e2062c
y.create.l HWIO_APPS_SMMU_CB1_TLBIVAAL_HIGH_2_APPS_ADDR A:0x61e2162c
y.create.l HWIO_APPS_SMMU_CB2_TLBIVAAL_HIGH_2_APPS_ADDR A:0x61e2262c
y.create.l HWIO_APPS_SMMU_CB3_TLBIVAAL_HIGH_2_APPS_ADDR A:0x61e2362c
y.create.l HWIO_APPS_SMMU_CB4_TLBIVAAL_HIGH_2_APPS_ADDR A:0x61e2462c
y.create.l HWIO_APPS_SMMU_CB5_TLBIVAAL_HIGH_2_APPS_ADDR A:0x61e2562c
y.create.l HWIO_APPS_SMMU_CB6_TLBIVAAL_HIGH_2_APPS_ADDR A:0x61e2662c
y.create.l HWIO_APPS_SMMU_CB7_TLBIVAAL_HIGH_2_APPS_ADDR A:0x61e2762c
y.create.l HWIO_APPS_SMMU_CB8_TLBIVAAL_HIGH_2_APPS_ADDR A:0x61e2862c
y.create.l HWIO_APPS_SMMU_CB9_TLBIVAAL_HIGH_2_APPS_ADDR A:0x61e2962c
y.create.l HWIO_APPS_SMMU_CB10_TLBIVAAL_HIGH_2_APPS_ADDR A:0x61e2a62c
y.create.l HWIO_APPS_SMMU_CB11_TLBIVAAL_HIGH_2_APPS_ADDR A:0x61e2b62c
y.create.l HWIO_APPS_SMMU_CB12_TLBIVAAL_HIGH_2_APPS_ADDR A:0x61e2c62c
y.create.l HWIO_APPS_SMMU_CB13_TLBIVAAL_HIGH_2_APPS_ADDR A:0x61e2d62c
y.create.l HWIO_APPS_SMMU_CB14_TLBIVAAL_HIGH_2_APPS_ADDR A:0x61e2e62c
y.create.l HWIO_APPS_SMMU_CB15_TLBIVAAL_HIGH_2_APPS_ADDR A:0x61e2f62c
y.create.l HWIO_APPS_SMMU_CB16_TLBIVAAL_HIGH_2_APPS_ADDR A:0x61e3062c
y.create.l HWIO_APPS_SMMU_CB17_TLBIVAAL_HIGH_2_APPS_ADDR A:0x61e3162c
y.create.l HWIO_APPS_SMMU_CB18_TLBIVAAL_HIGH_2_APPS_ADDR A:0x61e3262c
y.create.l HWIO_APPS_SMMU_CB19_TLBIVAAL_HIGH_2_APPS_ADDR A:0x61e3362c
y.create.l HWIO_APPS_SMMU_CB20_TLBIVAAL_HIGH_2_APPS_ADDR A:0x61e3462c
y.create.l HWIO_APPS_SMMU_CB21_TLBIVAAL_HIGH_2_APPS_ADDR A:0x61e3562c
y.create.l HWIO_APPS_SMMU_CB22_TLBIVAAL_HIGH_2_APPS_ADDR A:0x61e3662c
y.create.l HWIO_APPS_SMMU_CB23_TLBIVAAL_HIGH_2_APPS_ADDR A:0x61e3762c
y.create.l HWIO_APPS_SMMU_CB24_TLBIVAAL_HIGH_2_APPS_ADDR A:0x61e3862c
y.create.l HWIO_APPS_SMMU_CB25_TLBIVAAL_HIGH_2_APPS_ADDR A:0x61e3962c
y.create.l HWIO_APPS_SMMU_CB26_TLBIVAAL_HIGH_2_APPS_ADDR A:0x61e3a62c
y.create.l HWIO_APPS_SMMU_CB27_TLBIVAAL_HIGH_2_APPS_ADDR A:0x61e3b62c
y.create.l HWIO_APPS_SMMU_CB28_TLBIVAAL_HIGH_2_APPS_ADDR A:0x61e3c62c
y.create.l HWIO_APPS_SMMU_CB29_TLBIVAAL_HIGH_2_APPS_ADDR A:0x61e3d62c
y.create.l HWIO_APPS_SMMU_CB30_TLBIVAAL_HIGH_2_APPS_ADDR A:0x61e3e62c
y.create.l HWIO_APPS_SMMU_CB31_TLBIVAAL_HIGH_2_APPS_ADDR A:0x61e3f62c
y.create.l HWIO_APPS_SMMU_CB0_TLBIIPAS2_LOW_2_APPS_ADDR A:0x61e20630
y.create.l HWIO_APPS_SMMU_CB1_TLBIIPAS2_LOW_2_APPS_ADDR A:0x61e21630
y.create.l HWIO_APPS_SMMU_CB2_TLBIIPAS2_LOW_2_APPS_ADDR A:0x61e22630
y.create.l HWIO_APPS_SMMU_CB3_TLBIIPAS2_LOW_2_APPS_ADDR A:0x61e23630
y.create.l HWIO_APPS_SMMU_CB4_TLBIIPAS2_LOW_2_APPS_ADDR A:0x61e24630
y.create.l HWIO_APPS_SMMU_CB5_TLBIIPAS2_LOW_2_APPS_ADDR A:0x61e25630
y.create.l HWIO_APPS_SMMU_CB6_TLBIIPAS2_LOW_2_APPS_ADDR A:0x61e26630
y.create.l HWIO_APPS_SMMU_CB7_TLBIIPAS2_LOW_2_APPS_ADDR A:0x61e27630
y.create.l HWIO_APPS_SMMU_CB8_TLBIIPAS2_LOW_2_APPS_ADDR A:0x61e28630
y.create.l HWIO_APPS_SMMU_CB9_TLBIIPAS2_LOW_2_APPS_ADDR A:0x61e29630
y.create.l HWIO_APPS_SMMU_CB10_TLBIIPAS2_LOW_2_APPS_ADDR A:0x61e2a630
y.create.l HWIO_APPS_SMMU_CB11_TLBIIPAS2_LOW_2_APPS_ADDR A:0x61e2b630
y.create.l HWIO_APPS_SMMU_CB12_TLBIIPAS2_LOW_2_APPS_ADDR A:0x61e2c630
y.create.l HWIO_APPS_SMMU_CB13_TLBIIPAS2_LOW_2_APPS_ADDR A:0x61e2d630
y.create.l HWIO_APPS_SMMU_CB14_TLBIIPAS2_LOW_2_APPS_ADDR A:0x61e2e630
y.create.l HWIO_APPS_SMMU_CB15_TLBIIPAS2_LOW_2_APPS_ADDR A:0x61e2f630
y.create.l HWIO_APPS_SMMU_CB16_TLBIIPAS2_LOW_2_APPS_ADDR A:0x61e30630
y.create.l HWIO_APPS_SMMU_CB17_TLBIIPAS2_LOW_2_APPS_ADDR A:0x61e31630
y.create.l HWIO_APPS_SMMU_CB18_TLBIIPAS2_LOW_2_APPS_ADDR A:0x61e32630
y.create.l HWIO_APPS_SMMU_CB19_TLBIIPAS2_LOW_2_APPS_ADDR A:0x61e33630
y.create.l HWIO_APPS_SMMU_CB20_TLBIIPAS2_LOW_2_APPS_ADDR A:0x61e34630
y.create.l HWIO_APPS_SMMU_CB21_TLBIIPAS2_LOW_2_APPS_ADDR A:0x61e35630
y.create.l HWIO_APPS_SMMU_CB22_TLBIIPAS2_LOW_2_APPS_ADDR A:0x61e36630
y.create.l HWIO_APPS_SMMU_CB23_TLBIIPAS2_LOW_2_APPS_ADDR A:0x61e37630
y.create.l HWIO_APPS_SMMU_CB24_TLBIIPAS2_LOW_2_APPS_ADDR A:0x61e38630
y.create.l HWIO_APPS_SMMU_CB25_TLBIIPAS2_LOW_2_APPS_ADDR A:0x61e39630
y.create.l HWIO_APPS_SMMU_CB26_TLBIIPAS2_LOW_2_APPS_ADDR A:0x61e3a630
y.create.l HWIO_APPS_SMMU_CB27_TLBIIPAS2_LOW_2_APPS_ADDR A:0x61e3b630
y.create.l HWIO_APPS_SMMU_CB28_TLBIIPAS2_LOW_2_APPS_ADDR A:0x61e3c630
y.create.l HWIO_APPS_SMMU_CB29_TLBIIPAS2_LOW_2_APPS_ADDR A:0x61e3d630
y.create.l HWIO_APPS_SMMU_CB30_TLBIIPAS2_LOW_2_APPS_ADDR A:0x61e3e630
y.create.l HWIO_APPS_SMMU_CB31_TLBIIPAS2_LOW_2_APPS_ADDR A:0x61e3f630
y.create.l HWIO_APPS_SMMU_CB0_TLBIIPAS2_HIGH_2_APPS_ADDR A:0x61e20634
y.create.l HWIO_APPS_SMMU_CB1_TLBIIPAS2_HIGH_2_APPS_ADDR A:0x61e21634
y.create.l HWIO_APPS_SMMU_CB2_TLBIIPAS2_HIGH_2_APPS_ADDR A:0x61e22634
y.create.l HWIO_APPS_SMMU_CB3_TLBIIPAS2_HIGH_2_APPS_ADDR A:0x61e23634
y.create.l HWIO_APPS_SMMU_CB4_TLBIIPAS2_HIGH_2_APPS_ADDR A:0x61e24634
y.create.l HWIO_APPS_SMMU_CB5_TLBIIPAS2_HIGH_2_APPS_ADDR A:0x61e25634
y.create.l HWIO_APPS_SMMU_CB6_TLBIIPAS2_HIGH_2_APPS_ADDR A:0x61e26634
y.create.l HWIO_APPS_SMMU_CB7_TLBIIPAS2_HIGH_2_APPS_ADDR A:0x61e27634
y.create.l HWIO_APPS_SMMU_CB8_TLBIIPAS2_HIGH_2_APPS_ADDR A:0x61e28634
y.create.l HWIO_APPS_SMMU_CB9_TLBIIPAS2_HIGH_2_APPS_ADDR A:0x61e29634
y.create.l HWIO_APPS_SMMU_CB10_TLBIIPAS2_HIGH_2_APPS_ADDR A:0x61e2a634
y.create.l HWIO_APPS_SMMU_CB11_TLBIIPAS2_HIGH_2_APPS_ADDR A:0x61e2b634
y.create.l HWIO_APPS_SMMU_CB12_TLBIIPAS2_HIGH_2_APPS_ADDR A:0x61e2c634
y.create.l HWIO_APPS_SMMU_CB13_TLBIIPAS2_HIGH_2_APPS_ADDR A:0x61e2d634
y.create.l HWIO_APPS_SMMU_CB14_TLBIIPAS2_HIGH_2_APPS_ADDR A:0x61e2e634
y.create.l HWIO_APPS_SMMU_CB15_TLBIIPAS2_HIGH_2_APPS_ADDR A:0x61e2f634
y.create.l HWIO_APPS_SMMU_CB16_TLBIIPAS2_HIGH_2_APPS_ADDR A:0x61e30634
y.create.l HWIO_APPS_SMMU_CB17_TLBIIPAS2_HIGH_2_APPS_ADDR A:0x61e31634
y.create.l HWIO_APPS_SMMU_CB18_TLBIIPAS2_HIGH_2_APPS_ADDR A:0x61e32634
y.create.l HWIO_APPS_SMMU_CB19_TLBIIPAS2_HIGH_2_APPS_ADDR A:0x61e33634
y.create.l HWIO_APPS_SMMU_CB20_TLBIIPAS2_HIGH_2_APPS_ADDR A:0x61e34634
y.create.l HWIO_APPS_SMMU_CB21_TLBIIPAS2_HIGH_2_APPS_ADDR A:0x61e35634
y.create.l HWIO_APPS_SMMU_CB22_TLBIIPAS2_HIGH_2_APPS_ADDR A:0x61e36634
y.create.l HWIO_APPS_SMMU_CB23_TLBIIPAS2_HIGH_2_APPS_ADDR A:0x61e37634
y.create.l HWIO_APPS_SMMU_CB24_TLBIIPAS2_HIGH_2_APPS_ADDR A:0x61e38634
y.create.l HWIO_APPS_SMMU_CB25_TLBIIPAS2_HIGH_2_APPS_ADDR A:0x61e39634
y.create.l HWIO_APPS_SMMU_CB26_TLBIIPAS2_HIGH_2_APPS_ADDR A:0x61e3a634
y.create.l HWIO_APPS_SMMU_CB27_TLBIIPAS2_HIGH_2_APPS_ADDR A:0x61e3b634
y.create.l HWIO_APPS_SMMU_CB28_TLBIIPAS2_HIGH_2_APPS_ADDR A:0x61e3c634
y.create.l HWIO_APPS_SMMU_CB29_TLBIIPAS2_HIGH_2_APPS_ADDR A:0x61e3d634
y.create.l HWIO_APPS_SMMU_CB30_TLBIIPAS2_HIGH_2_APPS_ADDR A:0x61e3e634
y.create.l HWIO_APPS_SMMU_CB31_TLBIIPAS2_HIGH_2_APPS_ADDR A:0x61e3f634
y.create.l HWIO_APPS_SMMU_CB0_TLBIIPAS2L_LOW_2_APPS_ADDR A:0x61e20638
y.create.l HWIO_APPS_SMMU_CB1_TLBIIPAS2L_LOW_2_APPS_ADDR A:0x61e21638
y.create.l HWIO_APPS_SMMU_CB2_TLBIIPAS2L_LOW_2_APPS_ADDR A:0x61e22638
y.create.l HWIO_APPS_SMMU_CB3_TLBIIPAS2L_LOW_2_APPS_ADDR A:0x61e23638
y.create.l HWIO_APPS_SMMU_CB4_TLBIIPAS2L_LOW_2_APPS_ADDR A:0x61e24638
y.create.l HWIO_APPS_SMMU_CB5_TLBIIPAS2L_LOW_2_APPS_ADDR A:0x61e25638
y.create.l HWIO_APPS_SMMU_CB6_TLBIIPAS2L_LOW_2_APPS_ADDR A:0x61e26638
y.create.l HWIO_APPS_SMMU_CB7_TLBIIPAS2L_LOW_2_APPS_ADDR A:0x61e27638
y.create.l HWIO_APPS_SMMU_CB8_TLBIIPAS2L_LOW_2_APPS_ADDR A:0x61e28638
y.create.l HWIO_APPS_SMMU_CB9_TLBIIPAS2L_LOW_2_APPS_ADDR A:0x61e29638
y.create.l HWIO_APPS_SMMU_CB10_TLBIIPAS2L_LOW_2_APPS_ADDR A:0x61e2a638
y.create.l HWIO_APPS_SMMU_CB11_TLBIIPAS2L_LOW_2_APPS_ADDR A:0x61e2b638
y.create.l HWIO_APPS_SMMU_CB12_TLBIIPAS2L_LOW_2_APPS_ADDR A:0x61e2c638
y.create.l HWIO_APPS_SMMU_CB13_TLBIIPAS2L_LOW_2_APPS_ADDR A:0x61e2d638
y.create.l HWIO_APPS_SMMU_CB14_TLBIIPAS2L_LOW_2_APPS_ADDR A:0x61e2e638
y.create.l HWIO_APPS_SMMU_CB15_TLBIIPAS2L_LOW_2_APPS_ADDR A:0x61e2f638
y.create.l HWIO_APPS_SMMU_CB16_TLBIIPAS2L_LOW_2_APPS_ADDR A:0x61e30638
y.create.l HWIO_APPS_SMMU_CB17_TLBIIPAS2L_LOW_2_APPS_ADDR A:0x61e31638
y.create.l HWIO_APPS_SMMU_CB18_TLBIIPAS2L_LOW_2_APPS_ADDR A:0x61e32638
y.create.l HWIO_APPS_SMMU_CB19_TLBIIPAS2L_LOW_2_APPS_ADDR A:0x61e33638
y.create.l HWIO_APPS_SMMU_CB20_TLBIIPAS2L_LOW_2_APPS_ADDR A:0x61e34638
y.create.l HWIO_APPS_SMMU_CB21_TLBIIPAS2L_LOW_2_APPS_ADDR A:0x61e35638
y.create.l HWIO_APPS_SMMU_CB22_TLBIIPAS2L_LOW_2_APPS_ADDR A:0x61e36638
y.create.l HWIO_APPS_SMMU_CB23_TLBIIPAS2L_LOW_2_APPS_ADDR A:0x61e37638
y.create.l HWIO_APPS_SMMU_CB24_TLBIIPAS2L_LOW_2_APPS_ADDR A:0x61e38638
y.create.l HWIO_APPS_SMMU_CB25_TLBIIPAS2L_LOW_2_APPS_ADDR A:0x61e39638
y.create.l HWIO_APPS_SMMU_CB26_TLBIIPAS2L_LOW_2_APPS_ADDR A:0x61e3a638
y.create.l HWIO_APPS_SMMU_CB27_TLBIIPAS2L_LOW_2_APPS_ADDR A:0x61e3b638
y.create.l HWIO_APPS_SMMU_CB28_TLBIIPAS2L_LOW_2_APPS_ADDR A:0x61e3c638
y.create.l HWIO_APPS_SMMU_CB29_TLBIIPAS2L_LOW_2_APPS_ADDR A:0x61e3d638
y.create.l HWIO_APPS_SMMU_CB30_TLBIIPAS2L_LOW_2_APPS_ADDR A:0x61e3e638
y.create.l HWIO_APPS_SMMU_CB31_TLBIIPAS2L_LOW_2_APPS_ADDR A:0x61e3f638
y.create.l HWIO_APPS_SMMU_CB0_TLBIIPAS2L_HIGH_2_APPS_ADDR A:0x61e2063c
y.create.l HWIO_APPS_SMMU_CB1_TLBIIPAS2L_HIGH_2_APPS_ADDR A:0x61e2163c
y.create.l HWIO_APPS_SMMU_CB2_TLBIIPAS2L_HIGH_2_APPS_ADDR A:0x61e2263c
y.create.l HWIO_APPS_SMMU_CB3_TLBIIPAS2L_HIGH_2_APPS_ADDR A:0x61e2363c
y.create.l HWIO_APPS_SMMU_CB4_TLBIIPAS2L_HIGH_2_APPS_ADDR A:0x61e2463c
y.create.l HWIO_APPS_SMMU_CB5_TLBIIPAS2L_HIGH_2_APPS_ADDR A:0x61e2563c
y.create.l HWIO_APPS_SMMU_CB6_TLBIIPAS2L_HIGH_2_APPS_ADDR A:0x61e2663c
y.create.l HWIO_APPS_SMMU_CB7_TLBIIPAS2L_HIGH_2_APPS_ADDR A:0x61e2763c
y.create.l HWIO_APPS_SMMU_CB8_TLBIIPAS2L_HIGH_2_APPS_ADDR A:0x61e2863c
y.create.l HWIO_APPS_SMMU_CB9_TLBIIPAS2L_HIGH_2_APPS_ADDR A:0x61e2963c
y.create.l HWIO_APPS_SMMU_CB10_TLBIIPAS2L_HIGH_2_APPS_ADDR A:0x61e2a63c
y.create.l HWIO_APPS_SMMU_CB11_TLBIIPAS2L_HIGH_2_APPS_ADDR A:0x61e2b63c
y.create.l HWIO_APPS_SMMU_CB12_TLBIIPAS2L_HIGH_2_APPS_ADDR A:0x61e2c63c
y.create.l HWIO_APPS_SMMU_CB13_TLBIIPAS2L_HIGH_2_APPS_ADDR A:0x61e2d63c
y.create.l HWIO_APPS_SMMU_CB14_TLBIIPAS2L_HIGH_2_APPS_ADDR A:0x61e2e63c
y.create.l HWIO_APPS_SMMU_CB15_TLBIIPAS2L_HIGH_2_APPS_ADDR A:0x61e2f63c
y.create.l HWIO_APPS_SMMU_CB16_TLBIIPAS2L_HIGH_2_APPS_ADDR A:0x61e3063c
y.create.l HWIO_APPS_SMMU_CB17_TLBIIPAS2L_HIGH_2_APPS_ADDR A:0x61e3163c
y.create.l HWIO_APPS_SMMU_CB18_TLBIIPAS2L_HIGH_2_APPS_ADDR A:0x61e3263c
y.create.l HWIO_APPS_SMMU_CB19_TLBIIPAS2L_HIGH_2_APPS_ADDR A:0x61e3363c
y.create.l HWIO_APPS_SMMU_CB20_TLBIIPAS2L_HIGH_2_APPS_ADDR A:0x61e3463c
y.create.l HWIO_APPS_SMMU_CB21_TLBIIPAS2L_HIGH_2_APPS_ADDR A:0x61e3563c
y.create.l HWIO_APPS_SMMU_CB22_TLBIIPAS2L_HIGH_2_APPS_ADDR A:0x61e3663c
y.create.l HWIO_APPS_SMMU_CB23_TLBIIPAS2L_HIGH_2_APPS_ADDR A:0x61e3763c
y.create.l HWIO_APPS_SMMU_CB24_TLBIIPAS2L_HIGH_2_APPS_ADDR A:0x61e3863c
y.create.l HWIO_APPS_SMMU_CB25_TLBIIPAS2L_HIGH_2_APPS_ADDR A:0x61e3963c
y.create.l HWIO_APPS_SMMU_CB26_TLBIIPAS2L_HIGH_2_APPS_ADDR A:0x61e3a63c
y.create.l HWIO_APPS_SMMU_CB27_TLBIIPAS2L_HIGH_2_APPS_ADDR A:0x61e3b63c
y.create.l HWIO_APPS_SMMU_CB28_TLBIIPAS2L_HIGH_2_APPS_ADDR A:0x61e3c63c
y.create.l HWIO_APPS_SMMU_CB29_TLBIIPAS2L_HIGH_2_APPS_ADDR A:0x61e3d63c
y.create.l HWIO_APPS_SMMU_CB30_TLBIIPAS2L_HIGH_2_APPS_ADDR A:0x61e3e63c
y.create.l HWIO_APPS_SMMU_CB31_TLBIIPAS2L_HIGH_2_APPS_ADDR A:0x61e3f63c
y.create.l HWIO_APPS_SMMU_CB0_TLBSYNC_2_APPS_ADDR A:0x61e207f0
y.create.l HWIO_APPS_SMMU_CB1_TLBSYNC_2_APPS_ADDR A:0x61e217f0
y.create.l HWIO_APPS_SMMU_CB2_TLBSYNC_2_APPS_ADDR A:0x61e227f0
y.create.l HWIO_APPS_SMMU_CB3_TLBSYNC_2_APPS_ADDR A:0x61e237f0
y.create.l HWIO_APPS_SMMU_CB4_TLBSYNC_2_APPS_ADDR A:0x61e247f0
y.create.l HWIO_APPS_SMMU_CB5_TLBSYNC_2_APPS_ADDR A:0x61e257f0
y.create.l HWIO_APPS_SMMU_CB6_TLBSYNC_2_APPS_ADDR A:0x61e267f0
y.create.l HWIO_APPS_SMMU_CB7_TLBSYNC_2_APPS_ADDR A:0x61e277f0
y.create.l HWIO_APPS_SMMU_CB8_TLBSYNC_2_APPS_ADDR A:0x61e287f0
y.create.l HWIO_APPS_SMMU_CB9_TLBSYNC_2_APPS_ADDR A:0x61e297f0
y.create.l HWIO_APPS_SMMU_CB10_TLBSYNC_2_APPS_ADDR A:0x61e2a7f0
y.create.l HWIO_APPS_SMMU_CB11_TLBSYNC_2_APPS_ADDR A:0x61e2b7f0
y.create.l HWIO_APPS_SMMU_CB12_TLBSYNC_2_APPS_ADDR A:0x61e2c7f0
y.create.l HWIO_APPS_SMMU_CB13_TLBSYNC_2_APPS_ADDR A:0x61e2d7f0
y.create.l HWIO_APPS_SMMU_CB14_TLBSYNC_2_APPS_ADDR A:0x61e2e7f0
y.create.l HWIO_APPS_SMMU_CB15_TLBSYNC_2_APPS_ADDR A:0x61e2f7f0
y.create.l HWIO_APPS_SMMU_CB16_TLBSYNC_2_APPS_ADDR A:0x61e307f0
y.create.l HWIO_APPS_SMMU_CB17_TLBSYNC_2_APPS_ADDR A:0x61e317f0
y.create.l HWIO_APPS_SMMU_CB18_TLBSYNC_2_APPS_ADDR A:0x61e327f0
y.create.l HWIO_APPS_SMMU_CB19_TLBSYNC_2_APPS_ADDR A:0x61e337f0
y.create.l HWIO_APPS_SMMU_CB20_TLBSYNC_2_APPS_ADDR A:0x61e347f0
y.create.l HWIO_APPS_SMMU_CB21_TLBSYNC_2_APPS_ADDR A:0x61e357f0
y.create.l HWIO_APPS_SMMU_CB22_TLBSYNC_2_APPS_ADDR A:0x61e367f0
y.create.l HWIO_APPS_SMMU_CB23_TLBSYNC_2_APPS_ADDR A:0x61e377f0
y.create.l HWIO_APPS_SMMU_CB24_TLBSYNC_2_APPS_ADDR A:0x61e387f0
y.create.l HWIO_APPS_SMMU_CB25_TLBSYNC_2_APPS_ADDR A:0x61e397f0
y.create.l HWIO_APPS_SMMU_CB26_TLBSYNC_2_APPS_ADDR A:0x61e3a7f0
y.create.l HWIO_APPS_SMMU_CB27_TLBSYNC_2_APPS_ADDR A:0x61e3b7f0
y.create.l HWIO_APPS_SMMU_CB28_TLBSYNC_2_APPS_ADDR A:0x61e3c7f0
y.create.l HWIO_APPS_SMMU_CB29_TLBSYNC_2_APPS_ADDR A:0x61e3d7f0
y.create.l HWIO_APPS_SMMU_CB30_TLBSYNC_2_APPS_ADDR A:0x61e3e7f0
y.create.l HWIO_APPS_SMMU_CB31_TLBSYNC_2_APPS_ADDR A:0x61e3f7f0
y.create.l HWIO_APPS_SMMU_CB0_TLBSTATUS_2_APPS_ADDR A:0x61e207f4
y.create.l HWIO_APPS_SMMU_CB1_TLBSTATUS_2_APPS_ADDR A:0x61e217f4
y.create.l HWIO_APPS_SMMU_CB2_TLBSTATUS_2_APPS_ADDR A:0x61e227f4
y.create.l HWIO_APPS_SMMU_CB3_TLBSTATUS_2_APPS_ADDR A:0x61e237f4
y.create.l HWIO_APPS_SMMU_CB4_TLBSTATUS_2_APPS_ADDR A:0x61e247f4
y.create.l HWIO_APPS_SMMU_CB5_TLBSTATUS_2_APPS_ADDR A:0x61e257f4
y.create.l HWIO_APPS_SMMU_CB6_TLBSTATUS_2_APPS_ADDR A:0x61e267f4
y.create.l HWIO_APPS_SMMU_CB7_TLBSTATUS_2_APPS_ADDR A:0x61e277f4
y.create.l HWIO_APPS_SMMU_CB8_TLBSTATUS_2_APPS_ADDR A:0x61e287f4
y.create.l HWIO_APPS_SMMU_CB9_TLBSTATUS_2_APPS_ADDR A:0x61e297f4
y.create.l HWIO_APPS_SMMU_CB10_TLBSTATUS_2_APPS_ADDR A:0x61e2a7f4
y.create.l HWIO_APPS_SMMU_CB11_TLBSTATUS_2_APPS_ADDR A:0x61e2b7f4
y.create.l HWIO_APPS_SMMU_CB12_TLBSTATUS_2_APPS_ADDR A:0x61e2c7f4
y.create.l HWIO_APPS_SMMU_CB13_TLBSTATUS_2_APPS_ADDR A:0x61e2d7f4
y.create.l HWIO_APPS_SMMU_CB14_TLBSTATUS_2_APPS_ADDR A:0x61e2e7f4
y.create.l HWIO_APPS_SMMU_CB15_TLBSTATUS_2_APPS_ADDR A:0x61e2f7f4
y.create.l HWIO_APPS_SMMU_CB16_TLBSTATUS_2_APPS_ADDR A:0x61e307f4
y.create.l HWIO_APPS_SMMU_CB17_TLBSTATUS_2_APPS_ADDR A:0x61e317f4
y.create.l HWIO_APPS_SMMU_CB18_TLBSTATUS_2_APPS_ADDR A:0x61e327f4
y.create.l HWIO_APPS_SMMU_CB19_TLBSTATUS_2_APPS_ADDR A:0x61e337f4
y.create.l HWIO_APPS_SMMU_CB20_TLBSTATUS_2_APPS_ADDR A:0x61e347f4
y.create.l HWIO_APPS_SMMU_CB21_TLBSTATUS_2_APPS_ADDR A:0x61e357f4
y.create.l HWIO_APPS_SMMU_CB22_TLBSTATUS_2_APPS_ADDR A:0x61e367f4
y.create.l HWIO_APPS_SMMU_CB23_TLBSTATUS_2_APPS_ADDR A:0x61e377f4
y.create.l HWIO_APPS_SMMU_CB24_TLBSTATUS_2_APPS_ADDR A:0x61e387f4
y.create.l HWIO_APPS_SMMU_CB25_TLBSTATUS_2_APPS_ADDR A:0x61e397f4
y.create.l HWIO_APPS_SMMU_CB26_TLBSTATUS_2_APPS_ADDR A:0x61e3a7f4
y.create.l HWIO_APPS_SMMU_CB27_TLBSTATUS_2_APPS_ADDR A:0x61e3b7f4
y.create.l HWIO_APPS_SMMU_CB28_TLBSTATUS_2_APPS_ADDR A:0x61e3c7f4
y.create.l HWIO_APPS_SMMU_CB29_TLBSTATUS_2_APPS_ADDR A:0x61e3d7f4
y.create.l HWIO_APPS_SMMU_CB30_TLBSTATUS_2_APPS_ADDR A:0x61e3e7f4
y.create.l HWIO_APPS_SMMU_CB31_TLBSTATUS_2_APPS_ADDR A:0x61e3f7f4
y.create.l HWIO_APPS_SMMU_CB0_PMEVCNTR0_2_APPS_ADDR A:0x61e20e00
y.create.l HWIO_APPS_SMMU_CB1_PMEVCNTR0_2_APPS_ADDR A:0x61e21e00
y.create.l HWIO_APPS_SMMU_CB2_PMEVCNTR0_2_APPS_ADDR A:0x61e22e00
y.create.l HWIO_APPS_SMMU_CB3_PMEVCNTR0_2_APPS_ADDR A:0x61e23e00
y.create.l HWIO_APPS_SMMU_CB4_PMEVCNTR0_2_APPS_ADDR A:0x61e24e00
y.create.l HWIO_APPS_SMMU_CB5_PMEVCNTR0_2_APPS_ADDR A:0x61e25e00
y.create.l HWIO_APPS_SMMU_CB6_PMEVCNTR0_2_APPS_ADDR A:0x61e26e00
y.create.l HWIO_APPS_SMMU_CB7_PMEVCNTR0_2_APPS_ADDR A:0x61e27e00
y.create.l HWIO_APPS_SMMU_CB8_PMEVCNTR0_2_APPS_ADDR A:0x61e28e00
y.create.l HWIO_APPS_SMMU_CB9_PMEVCNTR0_2_APPS_ADDR A:0x61e29e00
y.create.l HWIO_APPS_SMMU_CB10_PMEVCNTR0_2_APPS_ADDR A:0x61e2ae00
y.create.l HWIO_APPS_SMMU_CB11_PMEVCNTR0_2_APPS_ADDR A:0x61e2be00
y.create.l HWIO_APPS_SMMU_CB12_PMEVCNTR0_2_APPS_ADDR A:0x61e2ce00
y.create.l HWIO_APPS_SMMU_CB13_PMEVCNTR0_2_APPS_ADDR A:0x61e2de00
y.create.l HWIO_APPS_SMMU_CB14_PMEVCNTR0_2_APPS_ADDR A:0x61e2ee00
y.create.l HWIO_APPS_SMMU_CB15_PMEVCNTR0_2_APPS_ADDR A:0x61e2fe00
y.create.l HWIO_APPS_SMMU_CB16_PMEVCNTR0_2_APPS_ADDR A:0x61e30e00
y.create.l HWIO_APPS_SMMU_CB17_PMEVCNTR0_2_APPS_ADDR A:0x61e31e00
y.create.l HWIO_APPS_SMMU_CB18_PMEVCNTR0_2_APPS_ADDR A:0x61e32e00
y.create.l HWIO_APPS_SMMU_CB19_PMEVCNTR0_2_APPS_ADDR A:0x61e33e00
y.create.l HWIO_APPS_SMMU_CB20_PMEVCNTR0_2_APPS_ADDR A:0x61e34e00
y.create.l HWIO_APPS_SMMU_CB21_PMEVCNTR0_2_APPS_ADDR A:0x61e35e00
y.create.l HWIO_APPS_SMMU_CB22_PMEVCNTR0_2_APPS_ADDR A:0x61e36e00
y.create.l HWIO_APPS_SMMU_CB23_PMEVCNTR0_2_APPS_ADDR A:0x61e37e00
y.create.l HWIO_APPS_SMMU_CB24_PMEVCNTR0_2_APPS_ADDR A:0x61e38e00
y.create.l HWIO_APPS_SMMU_CB25_PMEVCNTR0_2_APPS_ADDR A:0x61e39e00
y.create.l HWIO_APPS_SMMU_CB26_PMEVCNTR0_2_APPS_ADDR A:0x61e3ae00
y.create.l HWIO_APPS_SMMU_CB27_PMEVCNTR0_2_APPS_ADDR A:0x61e3be00
y.create.l HWIO_APPS_SMMU_CB28_PMEVCNTR0_2_APPS_ADDR A:0x61e3ce00
y.create.l HWIO_APPS_SMMU_CB29_PMEVCNTR0_2_APPS_ADDR A:0x61e3de00
y.create.l HWIO_APPS_SMMU_CB30_PMEVCNTR0_2_APPS_ADDR A:0x61e3ee00
y.create.l HWIO_APPS_SMMU_CB31_PMEVCNTR0_2_APPS_ADDR A:0x61e3fe00
y.create.l HWIO_APPS_SMMU_CB0_PMEVCNTR1_2_APPS_ADDR A:0x61e20e04
y.create.l HWIO_APPS_SMMU_CB1_PMEVCNTR1_2_APPS_ADDR A:0x61e21e04
y.create.l HWIO_APPS_SMMU_CB2_PMEVCNTR1_2_APPS_ADDR A:0x61e22e04
y.create.l HWIO_APPS_SMMU_CB3_PMEVCNTR1_2_APPS_ADDR A:0x61e23e04
y.create.l HWIO_APPS_SMMU_CB4_PMEVCNTR1_2_APPS_ADDR A:0x61e24e04
y.create.l HWIO_APPS_SMMU_CB5_PMEVCNTR1_2_APPS_ADDR A:0x61e25e04
y.create.l HWIO_APPS_SMMU_CB6_PMEVCNTR1_2_APPS_ADDR A:0x61e26e04
y.create.l HWIO_APPS_SMMU_CB7_PMEVCNTR1_2_APPS_ADDR A:0x61e27e04
y.create.l HWIO_APPS_SMMU_CB8_PMEVCNTR1_2_APPS_ADDR A:0x61e28e04
y.create.l HWIO_APPS_SMMU_CB9_PMEVCNTR1_2_APPS_ADDR A:0x61e29e04
y.create.l HWIO_APPS_SMMU_CB10_PMEVCNTR1_2_APPS_ADDR A:0x61e2ae04
y.create.l HWIO_APPS_SMMU_CB11_PMEVCNTR1_2_APPS_ADDR A:0x61e2be04
y.create.l HWIO_APPS_SMMU_CB12_PMEVCNTR1_2_APPS_ADDR A:0x61e2ce04
y.create.l HWIO_APPS_SMMU_CB13_PMEVCNTR1_2_APPS_ADDR A:0x61e2de04
y.create.l HWIO_APPS_SMMU_CB14_PMEVCNTR1_2_APPS_ADDR A:0x61e2ee04
y.create.l HWIO_APPS_SMMU_CB15_PMEVCNTR1_2_APPS_ADDR A:0x61e2fe04
y.create.l HWIO_APPS_SMMU_CB16_PMEVCNTR1_2_APPS_ADDR A:0x61e30e04
y.create.l HWIO_APPS_SMMU_CB17_PMEVCNTR1_2_APPS_ADDR A:0x61e31e04
y.create.l HWIO_APPS_SMMU_CB18_PMEVCNTR1_2_APPS_ADDR A:0x61e32e04
y.create.l HWIO_APPS_SMMU_CB19_PMEVCNTR1_2_APPS_ADDR A:0x61e33e04
y.create.l HWIO_APPS_SMMU_CB20_PMEVCNTR1_2_APPS_ADDR A:0x61e34e04
y.create.l HWIO_APPS_SMMU_CB21_PMEVCNTR1_2_APPS_ADDR A:0x61e35e04
y.create.l HWIO_APPS_SMMU_CB22_PMEVCNTR1_2_APPS_ADDR A:0x61e36e04
y.create.l HWIO_APPS_SMMU_CB23_PMEVCNTR1_2_APPS_ADDR A:0x61e37e04
y.create.l HWIO_APPS_SMMU_CB24_PMEVCNTR1_2_APPS_ADDR A:0x61e38e04
y.create.l HWIO_APPS_SMMU_CB25_PMEVCNTR1_2_APPS_ADDR A:0x61e39e04
y.create.l HWIO_APPS_SMMU_CB26_PMEVCNTR1_2_APPS_ADDR A:0x61e3ae04
y.create.l HWIO_APPS_SMMU_CB27_PMEVCNTR1_2_APPS_ADDR A:0x61e3be04
y.create.l HWIO_APPS_SMMU_CB28_PMEVCNTR1_2_APPS_ADDR A:0x61e3ce04
y.create.l HWIO_APPS_SMMU_CB29_PMEVCNTR1_2_APPS_ADDR A:0x61e3de04
y.create.l HWIO_APPS_SMMU_CB30_PMEVCNTR1_2_APPS_ADDR A:0x61e3ee04
y.create.l HWIO_APPS_SMMU_CB31_PMEVCNTR1_2_APPS_ADDR A:0x61e3fe04
y.create.l HWIO_APPS_SMMU_CB0_PMEVCNTR2_2_APPS_ADDR A:0x61e20e08
y.create.l HWIO_APPS_SMMU_CB1_PMEVCNTR2_2_APPS_ADDR A:0x61e21e08
y.create.l HWIO_APPS_SMMU_CB2_PMEVCNTR2_2_APPS_ADDR A:0x61e22e08
y.create.l HWIO_APPS_SMMU_CB3_PMEVCNTR2_2_APPS_ADDR A:0x61e23e08
y.create.l HWIO_APPS_SMMU_CB4_PMEVCNTR2_2_APPS_ADDR A:0x61e24e08
y.create.l HWIO_APPS_SMMU_CB5_PMEVCNTR2_2_APPS_ADDR A:0x61e25e08
y.create.l HWIO_APPS_SMMU_CB6_PMEVCNTR2_2_APPS_ADDR A:0x61e26e08
y.create.l HWIO_APPS_SMMU_CB7_PMEVCNTR2_2_APPS_ADDR A:0x61e27e08
y.create.l HWIO_APPS_SMMU_CB8_PMEVCNTR2_2_APPS_ADDR A:0x61e28e08
y.create.l HWIO_APPS_SMMU_CB9_PMEVCNTR2_2_APPS_ADDR A:0x61e29e08
y.create.l HWIO_APPS_SMMU_CB10_PMEVCNTR2_2_APPS_ADDR A:0x61e2ae08
y.create.l HWIO_APPS_SMMU_CB11_PMEVCNTR2_2_APPS_ADDR A:0x61e2be08
y.create.l HWIO_APPS_SMMU_CB12_PMEVCNTR2_2_APPS_ADDR A:0x61e2ce08
y.create.l HWIO_APPS_SMMU_CB13_PMEVCNTR2_2_APPS_ADDR A:0x61e2de08
y.create.l HWIO_APPS_SMMU_CB14_PMEVCNTR2_2_APPS_ADDR A:0x61e2ee08
y.create.l HWIO_APPS_SMMU_CB15_PMEVCNTR2_2_APPS_ADDR A:0x61e2fe08
y.create.l HWIO_APPS_SMMU_CB16_PMEVCNTR2_2_APPS_ADDR A:0x61e30e08
y.create.l HWIO_APPS_SMMU_CB17_PMEVCNTR2_2_APPS_ADDR A:0x61e31e08
y.create.l HWIO_APPS_SMMU_CB18_PMEVCNTR2_2_APPS_ADDR A:0x61e32e08
y.create.l HWIO_APPS_SMMU_CB19_PMEVCNTR2_2_APPS_ADDR A:0x61e33e08
y.create.l HWIO_APPS_SMMU_CB20_PMEVCNTR2_2_APPS_ADDR A:0x61e34e08
y.create.l HWIO_APPS_SMMU_CB21_PMEVCNTR2_2_APPS_ADDR A:0x61e35e08
y.create.l HWIO_APPS_SMMU_CB22_PMEVCNTR2_2_APPS_ADDR A:0x61e36e08
y.create.l HWIO_APPS_SMMU_CB23_PMEVCNTR2_2_APPS_ADDR A:0x61e37e08
y.create.l HWIO_APPS_SMMU_CB24_PMEVCNTR2_2_APPS_ADDR A:0x61e38e08
y.create.l HWIO_APPS_SMMU_CB25_PMEVCNTR2_2_APPS_ADDR A:0x61e39e08
y.create.l HWIO_APPS_SMMU_CB26_PMEVCNTR2_2_APPS_ADDR A:0x61e3ae08
y.create.l HWIO_APPS_SMMU_CB27_PMEVCNTR2_2_APPS_ADDR A:0x61e3be08
y.create.l HWIO_APPS_SMMU_CB28_PMEVCNTR2_2_APPS_ADDR A:0x61e3ce08
y.create.l HWIO_APPS_SMMU_CB29_PMEVCNTR2_2_APPS_ADDR A:0x61e3de08
y.create.l HWIO_APPS_SMMU_CB30_PMEVCNTR2_2_APPS_ADDR A:0x61e3ee08
y.create.l HWIO_APPS_SMMU_CB31_PMEVCNTR2_2_APPS_ADDR A:0x61e3fe08
y.create.l HWIO_APPS_SMMU_CB0_PMEVCNTR3_2_APPS_ADDR A:0x61e20e0c
y.create.l HWIO_APPS_SMMU_CB1_PMEVCNTR3_2_APPS_ADDR A:0x61e21e0c
y.create.l HWIO_APPS_SMMU_CB2_PMEVCNTR3_2_APPS_ADDR A:0x61e22e0c
y.create.l HWIO_APPS_SMMU_CB3_PMEVCNTR3_2_APPS_ADDR A:0x61e23e0c
y.create.l HWIO_APPS_SMMU_CB4_PMEVCNTR3_2_APPS_ADDR A:0x61e24e0c
y.create.l HWIO_APPS_SMMU_CB5_PMEVCNTR3_2_APPS_ADDR A:0x61e25e0c
y.create.l HWIO_APPS_SMMU_CB6_PMEVCNTR3_2_APPS_ADDR A:0x61e26e0c
y.create.l HWIO_APPS_SMMU_CB7_PMEVCNTR3_2_APPS_ADDR A:0x61e27e0c
y.create.l HWIO_APPS_SMMU_CB8_PMEVCNTR3_2_APPS_ADDR A:0x61e28e0c
y.create.l HWIO_APPS_SMMU_CB9_PMEVCNTR3_2_APPS_ADDR A:0x61e29e0c
y.create.l HWIO_APPS_SMMU_CB10_PMEVCNTR3_2_APPS_ADDR A:0x61e2ae0c
y.create.l HWIO_APPS_SMMU_CB11_PMEVCNTR3_2_APPS_ADDR A:0x61e2be0c
y.create.l HWIO_APPS_SMMU_CB12_PMEVCNTR3_2_APPS_ADDR A:0x61e2ce0c
y.create.l HWIO_APPS_SMMU_CB13_PMEVCNTR3_2_APPS_ADDR A:0x61e2de0c
y.create.l HWIO_APPS_SMMU_CB14_PMEVCNTR3_2_APPS_ADDR A:0x61e2ee0c
y.create.l HWIO_APPS_SMMU_CB15_PMEVCNTR3_2_APPS_ADDR A:0x61e2fe0c
y.create.l HWIO_APPS_SMMU_CB16_PMEVCNTR3_2_APPS_ADDR A:0x61e30e0c
y.create.l HWIO_APPS_SMMU_CB17_PMEVCNTR3_2_APPS_ADDR A:0x61e31e0c
y.create.l HWIO_APPS_SMMU_CB18_PMEVCNTR3_2_APPS_ADDR A:0x61e32e0c
y.create.l HWIO_APPS_SMMU_CB19_PMEVCNTR3_2_APPS_ADDR A:0x61e33e0c
y.create.l HWIO_APPS_SMMU_CB20_PMEVCNTR3_2_APPS_ADDR A:0x61e34e0c
y.create.l HWIO_APPS_SMMU_CB21_PMEVCNTR3_2_APPS_ADDR A:0x61e35e0c
y.create.l HWIO_APPS_SMMU_CB22_PMEVCNTR3_2_APPS_ADDR A:0x61e36e0c
y.create.l HWIO_APPS_SMMU_CB23_PMEVCNTR3_2_APPS_ADDR A:0x61e37e0c
y.create.l HWIO_APPS_SMMU_CB24_PMEVCNTR3_2_APPS_ADDR A:0x61e38e0c
y.create.l HWIO_APPS_SMMU_CB25_PMEVCNTR3_2_APPS_ADDR A:0x61e39e0c
y.create.l HWIO_APPS_SMMU_CB26_PMEVCNTR3_2_APPS_ADDR A:0x61e3ae0c
y.create.l HWIO_APPS_SMMU_CB27_PMEVCNTR3_2_APPS_ADDR A:0x61e3be0c
y.create.l HWIO_APPS_SMMU_CB28_PMEVCNTR3_2_APPS_ADDR A:0x61e3ce0c
y.create.l HWIO_APPS_SMMU_CB29_PMEVCNTR3_2_APPS_ADDR A:0x61e3de0c
y.create.l HWIO_APPS_SMMU_CB30_PMEVCNTR3_2_APPS_ADDR A:0x61e3ee0c
y.create.l HWIO_APPS_SMMU_CB31_PMEVCNTR3_2_APPS_ADDR A:0x61e3fe0c
y.create.l HWIO_APPS_SMMU_CB0_PMEVTYPER0_2_APPS_ADDR A:0x61e20e80
y.create.l HWIO_APPS_SMMU_CB1_PMEVTYPER0_2_APPS_ADDR A:0x61e21e80
y.create.l HWIO_APPS_SMMU_CB2_PMEVTYPER0_2_APPS_ADDR A:0x61e22e80
y.create.l HWIO_APPS_SMMU_CB3_PMEVTYPER0_2_APPS_ADDR A:0x61e23e80
y.create.l HWIO_APPS_SMMU_CB4_PMEVTYPER0_2_APPS_ADDR A:0x61e24e80
y.create.l HWIO_APPS_SMMU_CB5_PMEVTYPER0_2_APPS_ADDR A:0x61e25e80
y.create.l HWIO_APPS_SMMU_CB6_PMEVTYPER0_2_APPS_ADDR A:0x61e26e80
y.create.l HWIO_APPS_SMMU_CB7_PMEVTYPER0_2_APPS_ADDR A:0x61e27e80
y.create.l HWIO_APPS_SMMU_CB8_PMEVTYPER0_2_APPS_ADDR A:0x61e28e80
y.create.l HWIO_APPS_SMMU_CB9_PMEVTYPER0_2_APPS_ADDR A:0x61e29e80
y.create.l HWIO_APPS_SMMU_CB10_PMEVTYPER0_2_APPS_ADDR A:0x61e2ae80
y.create.l HWIO_APPS_SMMU_CB11_PMEVTYPER0_2_APPS_ADDR A:0x61e2be80
y.create.l HWIO_APPS_SMMU_CB12_PMEVTYPER0_2_APPS_ADDR A:0x61e2ce80
y.create.l HWIO_APPS_SMMU_CB13_PMEVTYPER0_2_APPS_ADDR A:0x61e2de80
y.create.l HWIO_APPS_SMMU_CB14_PMEVTYPER0_2_APPS_ADDR A:0x61e2ee80
y.create.l HWIO_APPS_SMMU_CB15_PMEVTYPER0_2_APPS_ADDR A:0x61e2fe80
y.create.l HWIO_APPS_SMMU_CB16_PMEVTYPER0_2_APPS_ADDR A:0x61e30e80
y.create.l HWIO_APPS_SMMU_CB17_PMEVTYPER0_2_APPS_ADDR A:0x61e31e80
y.create.l HWIO_APPS_SMMU_CB18_PMEVTYPER0_2_APPS_ADDR A:0x61e32e80
y.create.l HWIO_APPS_SMMU_CB19_PMEVTYPER0_2_APPS_ADDR A:0x61e33e80
y.create.l HWIO_APPS_SMMU_CB20_PMEVTYPER0_2_APPS_ADDR A:0x61e34e80
y.create.l HWIO_APPS_SMMU_CB21_PMEVTYPER0_2_APPS_ADDR A:0x61e35e80
y.create.l HWIO_APPS_SMMU_CB22_PMEVTYPER0_2_APPS_ADDR A:0x61e36e80
y.create.l HWIO_APPS_SMMU_CB23_PMEVTYPER0_2_APPS_ADDR A:0x61e37e80
y.create.l HWIO_APPS_SMMU_CB24_PMEVTYPER0_2_APPS_ADDR A:0x61e38e80
y.create.l HWIO_APPS_SMMU_CB25_PMEVTYPER0_2_APPS_ADDR A:0x61e39e80
y.create.l HWIO_APPS_SMMU_CB26_PMEVTYPER0_2_APPS_ADDR A:0x61e3ae80
y.create.l HWIO_APPS_SMMU_CB27_PMEVTYPER0_2_APPS_ADDR A:0x61e3be80
y.create.l HWIO_APPS_SMMU_CB28_PMEVTYPER0_2_APPS_ADDR A:0x61e3ce80
y.create.l HWIO_APPS_SMMU_CB29_PMEVTYPER0_2_APPS_ADDR A:0x61e3de80
y.create.l HWIO_APPS_SMMU_CB30_PMEVTYPER0_2_APPS_ADDR A:0x61e3ee80
y.create.l HWIO_APPS_SMMU_CB31_PMEVTYPER0_2_APPS_ADDR A:0x61e3fe80
y.create.l HWIO_APPS_SMMU_CB0_PMEVTYPER1_2_APPS_ADDR A:0x61e20e84
y.create.l HWIO_APPS_SMMU_CB1_PMEVTYPER1_2_APPS_ADDR A:0x61e21e84
y.create.l HWIO_APPS_SMMU_CB2_PMEVTYPER1_2_APPS_ADDR A:0x61e22e84
y.create.l HWIO_APPS_SMMU_CB3_PMEVTYPER1_2_APPS_ADDR A:0x61e23e84
y.create.l HWIO_APPS_SMMU_CB4_PMEVTYPER1_2_APPS_ADDR A:0x61e24e84
y.create.l HWIO_APPS_SMMU_CB5_PMEVTYPER1_2_APPS_ADDR A:0x61e25e84
y.create.l HWIO_APPS_SMMU_CB6_PMEVTYPER1_2_APPS_ADDR A:0x61e26e84
y.create.l HWIO_APPS_SMMU_CB7_PMEVTYPER1_2_APPS_ADDR A:0x61e27e84
y.create.l HWIO_APPS_SMMU_CB8_PMEVTYPER1_2_APPS_ADDR A:0x61e28e84
y.create.l HWIO_APPS_SMMU_CB9_PMEVTYPER1_2_APPS_ADDR A:0x61e29e84
y.create.l HWIO_APPS_SMMU_CB10_PMEVTYPER1_2_APPS_ADDR A:0x61e2ae84
y.create.l HWIO_APPS_SMMU_CB11_PMEVTYPER1_2_APPS_ADDR A:0x61e2be84
y.create.l HWIO_APPS_SMMU_CB12_PMEVTYPER1_2_APPS_ADDR A:0x61e2ce84
y.create.l HWIO_APPS_SMMU_CB13_PMEVTYPER1_2_APPS_ADDR A:0x61e2de84
y.create.l HWIO_APPS_SMMU_CB14_PMEVTYPER1_2_APPS_ADDR A:0x61e2ee84
y.create.l HWIO_APPS_SMMU_CB15_PMEVTYPER1_2_APPS_ADDR A:0x61e2fe84
y.create.l HWIO_APPS_SMMU_CB16_PMEVTYPER1_2_APPS_ADDR A:0x61e30e84
y.create.l HWIO_APPS_SMMU_CB17_PMEVTYPER1_2_APPS_ADDR A:0x61e31e84
y.create.l HWIO_APPS_SMMU_CB18_PMEVTYPER1_2_APPS_ADDR A:0x61e32e84
y.create.l HWIO_APPS_SMMU_CB19_PMEVTYPER1_2_APPS_ADDR A:0x61e33e84
y.create.l HWIO_APPS_SMMU_CB20_PMEVTYPER1_2_APPS_ADDR A:0x61e34e84
y.create.l HWIO_APPS_SMMU_CB21_PMEVTYPER1_2_APPS_ADDR A:0x61e35e84
y.create.l HWIO_APPS_SMMU_CB22_PMEVTYPER1_2_APPS_ADDR A:0x61e36e84
y.create.l HWIO_APPS_SMMU_CB23_PMEVTYPER1_2_APPS_ADDR A:0x61e37e84
y.create.l HWIO_APPS_SMMU_CB24_PMEVTYPER1_2_APPS_ADDR A:0x61e38e84
y.create.l HWIO_APPS_SMMU_CB25_PMEVTYPER1_2_APPS_ADDR A:0x61e39e84
y.create.l HWIO_APPS_SMMU_CB26_PMEVTYPER1_2_APPS_ADDR A:0x61e3ae84
y.create.l HWIO_APPS_SMMU_CB27_PMEVTYPER1_2_APPS_ADDR A:0x61e3be84
y.create.l HWIO_APPS_SMMU_CB28_PMEVTYPER1_2_APPS_ADDR A:0x61e3ce84
y.create.l HWIO_APPS_SMMU_CB29_PMEVTYPER1_2_APPS_ADDR A:0x61e3de84
y.create.l HWIO_APPS_SMMU_CB30_PMEVTYPER1_2_APPS_ADDR A:0x61e3ee84
y.create.l HWIO_APPS_SMMU_CB31_PMEVTYPER1_2_APPS_ADDR A:0x61e3fe84
y.create.l HWIO_APPS_SMMU_CB0_PMEVTYPER2_2_APPS_ADDR A:0x61e20e88
y.create.l HWIO_APPS_SMMU_CB1_PMEVTYPER2_2_APPS_ADDR A:0x61e21e88
y.create.l HWIO_APPS_SMMU_CB2_PMEVTYPER2_2_APPS_ADDR A:0x61e22e88
y.create.l HWIO_APPS_SMMU_CB3_PMEVTYPER2_2_APPS_ADDR A:0x61e23e88
y.create.l HWIO_APPS_SMMU_CB4_PMEVTYPER2_2_APPS_ADDR A:0x61e24e88
y.create.l HWIO_APPS_SMMU_CB5_PMEVTYPER2_2_APPS_ADDR A:0x61e25e88
y.create.l HWIO_APPS_SMMU_CB6_PMEVTYPER2_2_APPS_ADDR A:0x61e26e88
y.create.l HWIO_APPS_SMMU_CB7_PMEVTYPER2_2_APPS_ADDR A:0x61e27e88
y.create.l HWIO_APPS_SMMU_CB8_PMEVTYPER2_2_APPS_ADDR A:0x61e28e88
y.create.l HWIO_APPS_SMMU_CB9_PMEVTYPER2_2_APPS_ADDR A:0x61e29e88
y.create.l HWIO_APPS_SMMU_CB10_PMEVTYPER2_2_APPS_ADDR A:0x61e2ae88
y.create.l HWIO_APPS_SMMU_CB11_PMEVTYPER2_2_APPS_ADDR A:0x61e2be88
y.create.l HWIO_APPS_SMMU_CB12_PMEVTYPER2_2_APPS_ADDR A:0x61e2ce88
y.create.l HWIO_APPS_SMMU_CB13_PMEVTYPER2_2_APPS_ADDR A:0x61e2de88
y.create.l HWIO_APPS_SMMU_CB14_PMEVTYPER2_2_APPS_ADDR A:0x61e2ee88
y.create.l HWIO_APPS_SMMU_CB15_PMEVTYPER2_2_APPS_ADDR A:0x61e2fe88
y.create.l HWIO_APPS_SMMU_CB16_PMEVTYPER2_2_APPS_ADDR A:0x61e30e88
y.create.l HWIO_APPS_SMMU_CB17_PMEVTYPER2_2_APPS_ADDR A:0x61e31e88
y.create.l HWIO_APPS_SMMU_CB18_PMEVTYPER2_2_APPS_ADDR A:0x61e32e88
y.create.l HWIO_APPS_SMMU_CB19_PMEVTYPER2_2_APPS_ADDR A:0x61e33e88
y.create.l HWIO_APPS_SMMU_CB20_PMEVTYPER2_2_APPS_ADDR A:0x61e34e88
y.create.l HWIO_APPS_SMMU_CB21_PMEVTYPER2_2_APPS_ADDR A:0x61e35e88
y.create.l HWIO_APPS_SMMU_CB22_PMEVTYPER2_2_APPS_ADDR A:0x61e36e88
y.create.l HWIO_APPS_SMMU_CB23_PMEVTYPER2_2_APPS_ADDR A:0x61e37e88
y.create.l HWIO_APPS_SMMU_CB24_PMEVTYPER2_2_APPS_ADDR A:0x61e38e88
y.create.l HWIO_APPS_SMMU_CB25_PMEVTYPER2_2_APPS_ADDR A:0x61e39e88
y.create.l HWIO_APPS_SMMU_CB26_PMEVTYPER2_2_APPS_ADDR A:0x61e3ae88
y.create.l HWIO_APPS_SMMU_CB27_PMEVTYPER2_2_APPS_ADDR A:0x61e3be88
y.create.l HWIO_APPS_SMMU_CB28_PMEVTYPER2_2_APPS_ADDR A:0x61e3ce88
y.create.l HWIO_APPS_SMMU_CB29_PMEVTYPER2_2_APPS_ADDR A:0x61e3de88
y.create.l HWIO_APPS_SMMU_CB30_PMEVTYPER2_2_APPS_ADDR A:0x61e3ee88
y.create.l HWIO_APPS_SMMU_CB31_PMEVTYPER2_2_APPS_ADDR A:0x61e3fe88
y.create.l HWIO_APPS_SMMU_CB0_PMEVTYPER3_2_APPS_ADDR A:0x61e20e8c
y.create.l HWIO_APPS_SMMU_CB1_PMEVTYPER3_2_APPS_ADDR A:0x61e21e8c
y.create.l HWIO_APPS_SMMU_CB2_PMEVTYPER3_2_APPS_ADDR A:0x61e22e8c
y.create.l HWIO_APPS_SMMU_CB3_PMEVTYPER3_2_APPS_ADDR A:0x61e23e8c
y.create.l HWIO_APPS_SMMU_CB4_PMEVTYPER3_2_APPS_ADDR A:0x61e24e8c
y.create.l HWIO_APPS_SMMU_CB5_PMEVTYPER3_2_APPS_ADDR A:0x61e25e8c
y.create.l HWIO_APPS_SMMU_CB6_PMEVTYPER3_2_APPS_ADDR A:0x61e26e8c
y.create.l HWIO_APPS_SMMU_CB7_PMEVTYPER3_2_APPS_ADDR A:0x61e27e8c
y.create.l HWIO_APPS_SMMU_CB8_PMEVTYPER3_2_APPS_ADDR A:0x61e28e8c
y.create.l HWIO_APPS_SMMU_CB9_PMEVTYPER3_2_APPS_ADDR A:0x61e29e8c
y.create.l HWIO_APPS_SMMU_CB10_PMEVTYPER3_2_APPS_ADDR A:0x61e2ae8c
y.create.l HWIO_APPS_SMMU_CB11_PMEVTYPER3_2_APPS_ADDR A:0x61e2be8c
y.create.l HWIO_APPS_SMMU_CB12_PMEVTYPER3_2_APPS_ADDR A:0x61e2ce8c
y.create.l HWIO_APPS_SMMU_CB13_PMEVTYPER3_2_APPS_ADDR A:0x61e2de8c
y.create.l HWIO_APPS_SMMU_CB14_PMEVTYPER3_2_APPS_ADDR A:0x61e2ee8c
y.create.l HWIO_APPS_SMMU_CB15_PMEVTYPER3_2_APPS_ADDR A:0x61e2fe8c
y.create.l HWIO_APPS_SMMU_CB16_PMEVTYPER3_2_APPS_ADDR A:0x61e30e8c
y.create.l HWIO_APPS_SMMU_CB17_PMEVTYPER3_2_APPS_ADDR A:0x61e31e8c
y.create.l HWIO_APPS_SMMU_CB18_PMEVTYPER3_2_APPS_ADDR A:0x61e32e8c
y.create.l HWIO_APPS_SMMU_CB19_PMEVTYPER3_2_APPS_ADDR A:0x61e33e8c
y.create.l HWIO_APPS_SMMU_CB20_PMEVTYPER3_2_APPS_ADDR A:0x61e34e8c
y.create.l HWIO_APPS_SMMU_CB21_PMEVTYPER3_2_APPS_ADDR A:0x61e35e8c
y.create.l HWIO_APPS_SMMU_CB22_PMEVTYPER3_2_APPS_ADDR A:0x61e36e8c
y.create.l HWIO_APPS_SMMU_CB23_PMEVTYPER3_2_APPS_ADDR A:0x61e37e8c
y.create.l HWIO_APPS_SMMU_CB24_PMEVTYPER3_2_APPS_ADDR A:0x61e38e8c
y.create.l HWIO_APPS_SMMU_CB25_PMEVTYPER3_2_APPS_ADDR A:0x61e39e8c
y.create.l HWIO_APPS_SMMU_CB26_PMEVTYPER3_2_APPS_ADDR A:0x61e3ae8c
y.create.l HWIO_APPS_SMMU_CB27_PMEVTYPER3_2_APPS_ADDR A:0x61e3be8c
y.create.l HWIO_APPS_SMMU_CB28_PMEVTYPER3_2_APPS_ADDR A:0x61e3ce8c
y.create.l HWIO_APPS_SMMU_CB29_PMEVTYPER3_2_APPS_ADDR A:0x61e3de8c
y.create.l HWIO_APPS_SMMU_CB30_PMEVTYPER3_2_APPS_ADDR A:0x61e3ee8c
y.create.l HWIO_APPS_SMMU_CB31_PMEVTYPER3_2_APPS_ADDR A:0x61e3fe8c
y.create.l HWIO_APPS_SMMU_CB0_PMCFGR_2_APPS_ADDR A:0x61e20f00
y.create.l HWIO_APPS_SMMU_CB1_PMCFGR_2_APPS_ADDR A:0x61e21f00
y.create.l HWIO_APPS_SMMU_CB2_PMCFGR_2_APPS_ADDR A:0x61e22f00
y.create.l HWIO_APPS_SMMU_CB3_PMCFGR_2_APPS_ADDR A:0x61e23f00
y.create.l HWIO_APPS_SMMU_CB4_PMCFGR_2_APPS_ADDR A:0x61e24f00
y.create.l HWIO_APPS_SMMU_CB5_PMCFGR_2_APPS_ADDR A:0x61e25f00
y.create.l HWIO_APPS_SMMU_CB6_PMCFGR_2_APPS_ADDR A:0x61e26f00
y.create.l HWIO_APPS_SMMU_CB7_PMCFGR_2_APPS_ADDR A:0x61e27f00
y.create.l HWIO_APPS_SMMU_CB8_PMCFGR_2_APPS_ADDR A:0x61e28f00
y.create.l HWIO_APPS_SMMU_CB9_PMCFGR_2_APPS_ADDR A:0x61e29f00
y.create.l HWIO_APPS_SMMU_CB10_PMCFGR_2_APPS_ADDR A:0x61e2af00
y.create.l HWIO_APPS_SMMU_CB11_PMCFGR_2_APPS_ADDR A:0x61e2bf00
y.create.l HWIO_APPS_SMMU_CB12_PMCFGR_2_APPS_ADDR A:0x61e2cf00
y.create.l HWIO_APPS_SMMU_CB13_PMCFGR_2_APPS_ADDR A:0x61e2df00
y.create.l HWIO_APPS_SMMU_CB14_PMCFGR_2_APPS_ADDR A:0x61e2ef00
y.create.l HWIO_APPS_SMMU_CB15_PMCFGR_2_APPS_ADDR A:0x61e2ff00
y.create.l HWIO_APPS_SMMU_CB16_PMCFGR_2_APPS_ADDR A:0x61e30f00
y.create.l HWIO_APPS_SMMU_CB17_PMCFGR_2_APPS_ADDR A:0x61e31f00
y.create.l HWIO_APPS_SMMU_CB18_PMCFGR_2_APPS_ADDR A:0x61e32f00
y.create.l HWIO_APPS_SMMU_CB19_PMCFGR_2_APPS_ADDR A:0x61e33f00
y.create.l HWIO_APPS_SMMU_CB20_PMCFGR_2_APPS_ADDR A:0x61e34f00
y.create.l HWIO_APPS_SMMU_CB21_PMCFGR_2_APPS_ADDR A:0x61e35f00
y.create.l HWIO_APPS_SMMU_CB22_PMCFGR_2_APPS_ADDR A:0x61e36f00
y.create.l HWIO_APPS_SMMU_CB23_PMCFGR_2_APPS_ADDR A:0x61e37f00
y.create.l HWIO_APPS_SMMU_CB24_PMCFGR_2_APPS_ADDR A:0x61e38f00
y.create.l HWIO_APPS_SMMU_CB25_PMCFGR_2_APPS_ADDR A:0x61e39f00
y.create.l HWIO_APPS_SMMU_CB26_PMCFGR_2_APPS_ADDR A:0x61e3af00
y.create.l HWIO_APPS_SMMU_CB27_PMCFGR_2_APPS_ADDR A:0x61e3bf00
y.create.l HWIO_APPS_SMMU_CB28_PMCFGR_2_APPS_ADDR A:0x61e3cf00
y.create.l HWIO_APPS_SMMU_CB29_PMCFGR_2_APPS_ADDR A:0x61e3df00
y.create.l HWIO_APPS_SMMU_CB30_PMCFGR_2_APPS_ADDR A:0x61e3ef00
y.create.l HWIO_APPS_SMMU_CB31_PMCFGR_2_APPS_ADDR A:0x61e3ff00
y.create.l HWIO_APPS_SMMU_CB0_PMCR_2_APPS_ADDR A:0x61e20f04
y.create.l HWIO_APPS_SMMU_CB1_PMCR_2_APPS_ADDR A:0x61e21f04
y.create.l HWIO_APPS_SMMU_CB2_PMCR_2_APPS_ADDR A:0x61e22f04
y.create.l HWIO_APPS_SMMU_CB3_PMCR_2_APPS_ADDR A:0x61e23f04
y.create.l HWIO_APPS_SMMU_CB4_PMCR_2_APPS_ADDR A:0x61e24f04
y.create.l HWIO_APPS_SMMU_CB5_PMCR_2_APPS_ADDR A:0x61e25f04
y.create.l HWIO_APPS_SMMU_CB6_PMCR_2_APPS_ADDR A:0x61e26f04
y.create.l HWIO_APPS_SMMU_CB7_PMCR_2_APPS_ADDR A:0x61e27f04
y.create.l HWIO_APPS_SMMU_CB8_PMCR_2_APPS_ADDR A:0x61e28f04
y.create.l HWIO_APPS_SMMU_CB9_PMCR_2_APPS_ADDR A:0x61e29f04
y.create.l HWIO_APPS_SMMU_CB10_PMCR_2_APPS_ADDR A:0x61e2af04
y.create.l HWIO_APPS_SMMU_CB11_PMCR_2_APPS_ADDR A:0x61e2bf04
y.create.l HWIO_APPS_SMMU_CB12_PMCR_2_APPS_ADDR A:0x61e2cf04
y.create.l HWIO_APPS_SMMU_CB13_PMCR_2_APPS_ADDR A:0x61e2df04
y.create.l HWIO_APPS_SMMU_CB14_PMCR_2_APPS_ADDR A:0x61e2ef04
y.create.l HWIO_APPS_SMMU_CB15_PMCR_2_APPS_ADDR A:0x61e2ff04
y.create.l HWIO_APPS_SMMU_CB16_PMCR_2_APPS_ADDR A:0x61e30f04
y.create.l HWIO_APPS_SMMU_CB17_PMCR_2_APPS_ADDR A:0x61e31f04
y.create.l HWIO_APPS_SMMU_CB18_PMCR_2_APPS_ADDR A:0x61e32f04
y.create.l HWIO_APPS_SMMU_CB19_PMCR_2_APPS_ADDR A:0x61e33f04
y.create.l HWIO_APPS_SMMU_CB20_PMCR_2_APPS_ADDR A:0x61e34f04
y.create.l HWIO_APPS_SMMU_CB21_PMCR_2_APPS_ADDR A:0x61e35f04
y.create.l HWIO_APPS_SMMU_CB22_PMCR_2_APPS_ADDR A:0x61e36f04
y.create.l HWIO_APPS_SMMU_CB23_PMCR_2_APPS_ADDR A:0x61e37f04
y.create.l HWIO_APPS_SMMU_CB24_PMCR_2_APPS_ADDR A:0x61e38f04
y.create.l HWIO_APPS_SMMU_CB25_PMCR_2_APPS_ADDR A:0x61e39f04
y.create.l HWIO_APPS_SMMU_CB26_PMCR_2_APPS_ADDR A:0x61e3af04
y.create.l HWIO_APPS_SMMU_CB27_PMCR_2_APPS_ADDR A:0x61e3bf04
y.create.l HWIO_APPS_SMMU_CB28_PMCR_2_APPS_ADDR A:0x61e3cf04
y.create.l HWIO_APPS_SMMU_CB29_PMCR_2_APPS_ADDR A:0x61e3df04
y.create.l HWIO_APPS_SMMU_CB30_PMCR_2_APPS_ADDR A:0x61e3ef04
y.create.l HWIO_APPS_SMMU_CB31_PMCR_2_APPS_ADDR A:0x61e3ff04
y.create.l HWIO_APPS_SMMU_CB0_PMCEID_2_APPS_ADDR A:0x61e20f20
y.create.l HWIO_APPS_SMMU_CB1_PMCEID_2_APPS_ADDR A:0x61e21f20
y.create.l HWIO_APPS_SMMU_CB2_PMCEID_2_APPS_ADDR A:0x61e22f20
y.create.l HWIO_APPS_SMMU_CB3_PMCEID_2_APPS_ADDR A:0x61e23f20
y.create.l HWIO_APPS_SMMU_CB4_PMCEID_2_APPS_ADDR A:0x61e24f20
y.create.l HWIO_APPS_SMMU_CB5_PMCEID_2_APPS_ADDR A:0x61e25f20
y.create.l HWIO_APPS_SMMU_CB6_PMCEID_2_APPS_ADDR A:0x61e26f20
y.create.l HWIO_APPS_SMMU_CB7_PMCEID_2_APPS_ADDR A:0x61e27f20
y.create.l HWIO_APPS_SMMU_CB8_PMCEID_2_APPS_ADDR A:0x61e28f20
y.create.l HWIO_APPS_SMMU_CB9_PMCEID_2_APPS_ADDR A:0x61e29f20
y.create.l HWIO_APPS_SMMU_CB10_PMCEID_2_APPS_ADDR A:0x61e2af20
y.create.l HWIO_APPS_SMMU_CB11_PMCEID_2_APPS_ADDR A:0x61e2bf20
y.create.l HWIO_APPS_SMMU_CB12_PMCEID_2_APPS_ADDR A:0x61e2cf20
y.create.l HWIO_APPS_SMMU_CB13_PMCEID_2_APPS_ADDR A:0x61e2df20
y.create.l HWIO_APPS_SMMU_CB14_PMCEID_2_APPS_ADDR A:0x61e2ef20
y.create.l HWIO_APPS_SMMU_CB15_PMCEID_2_APPS_ADDR A:0x61e2ff20
y.create.l HWIO_APPS_SMMU_CB16_PMCEID_2_APPS_ADDR A:0x61e30f20
y.create.l HWIO_APPS_SMMU_CB17_PMCEID_2_APPS_ADDR A:0x61e31f20
y.create.l HWIO_APPS_SMMU_CB18_PMCEID_2_APPS_ADDR A:0x61e32f20
y.create.l HWIO_APPS_SMMU_CB19_PMCEID_2_APPS_ADDR A:0x61e33f20
y.create.l HWIO_APPS_SMMU_CB20_PMCEID_2_APPS_ADDR A:0x61e34f20
y.create.l HWIO_APPS_SMMU_CB21_PMCEID_2_APPS_ADDR A:0x61e35f20
y.create.l HWIO_APPS_SMMU_CB22_PMCEID_2_APPS_ADDR A:0x61e36f20
y.create.l HWIO_APPS_SMMU_CB23_PMCEID_2_APPS_ADDR A:0x61e37f20
y.create.l HWIO_APPS_SMMU_CB24_PMCEID_2_APPS_ADDR A:0x61e38f20
y.create.l HWIO_APPS_SMMU_CB25_PMCEID_2_APPS_ADDR A:0x61e39f20
y.create.l HWIO_APPS_SMMU_CB26_PMCEID_2_APPS_ADDR A:0x61e3af20
y.create.l HWIO_APPS_SMMU_CB27_PMCEID_2_APPS_ADDR A:0x61e3bf20
y.create.l HWIO_APPS_SMMU_CB28_PMCEID_2_APPS_ADDR A:0x61e3cf20
y.create.l HWIO_APPS_SMMU_CB29_PMCEID_2_APPS_ADDR A:0x61e3df20
y.create.l HWIO_APPS_SMMU_CB30_PMCEID_2_APPS_ADDR A:0x61e3ef20
y.create.l HWIO_APPS_SMMU_CB31_PMCEID_2_APPS_ADDR A:0x61e3ff20
y.create.l HWIO_APPS_SMMU_CB0_PMCNTENSE_2_APPS_ADDR A:0x61e20f40
y.create.l HWIO_APPS_SMMU_CB1_PMCNTENSE_2_APPS_ADDR A:0x61e21f40
y.create.l HWIO_APPS_SMMU_CB2_PMCNTENSE_2_APPS_ADDR A:0x61e22f40
y.create.l HWIO_APPS_SMMU_CB3_PMCNTENSE_2_APPS_ADDR A:0x61e23f40
y.create.l HWIO_APPS_SMMU_CB4_PMCNTENSE_2_APPS_ADDR A:0x61e24f40
y.create.l HWIO_APPS_SMMU_CB5_PMCNTENSE_2_APPS_ADDR A:0x61e25f40
y.create.l HWIO_APPS_SMMU_CB6_PMCNTENSE_2_APPS_ADDR A:0x61e26f40
y.create.l HWIO_APPS_SMMU_CB7_PMCNTENSE_2_APPS_ADDR A:0x61e27f40
y.create.l HWIO_APPS_SMMU_CB8_PMCNTENSE_2_APPS_ADDR A:0x61e28f40
y.create.l HWIO_APPS_SMMU_CB9_PMCNTENSE_2_APPS_ADDR A:0x61e29f40
y.create.l HWIO_APPS_SMMU_CB10_PMCNTENSE_2_APPS_ADDR A:0x61e2af40
y.create.l HWIO_APPS_SMMU_CB11_PMCNTENSE_2_APPS_ADDR A:0x61e2bf40
y.create.l HWIO_APPS_SMMU_CB12_PMCNTENSE_2_APPS_ADDR A:0x61e2cf40
y.create.l HWIO_APPS_SMMU_CB13_PMCNTENSE_2_APPS_ADDR A:0x61e2df40
y.create.l HWIO_APPS_SMMU_CB14_PMCNTENSE_2_APPS_ADDR A:0x61e2ef40
y.create.l HWIO_APPS_SMMU_CB15_PMCNTENSE_2_APPS_ADDR A:0x61e2ff40
y.create.l HWIO_APPS_SMMU_CB16_PMCNTENSE_2_APPS_ADDR A:0x61e30f40
y.create.l HWIO_APPS_SMMU_CB17_PMCNTENSE_2_APPS_ADDR A:0x61e31f40
y.create.l HWIO_APPS_SMMU_CB18_PMCNTENSE_2_APPS_ADDR A:0x61e32f40
y.create.l HWIO_APPS_SMMU_CB19_PMCNTENSE_2_APPS_ADDR A:0x61e33f40
y.create.l HWIO_APPS_SMMU_CB20_PMCNTENSE_2_APPS_ADDR A:0x61e34f40
y.create.l HWIO_APPS_SMMU_CB21_PMCNTENSE_2_APPS_ADDR A:0x61e35f40
y.create.l HWIO_APPS_SMMU_CB22_PMCNTENSE_2_APPS_ADDR A:0x61e36f40
y.create.l HWIO_APPS_SMMU_CB23_PMCNTENSE_2_APPS_ADDR A:0x61e37f40
y.create.l HWIO_APPS_SMMU_CB24_PMCNTENSE_2_APPS_ADDR A:0x61e38f40
y.create.l HWIO_APPS_SMMU_CB25_PMCNTENSE_2_APPS_ADDR A:0x61e39f40
y.create.l HWIO_APPS_SMMU_CB26_PMCNTENSE_2_APPS_ADDR A:0x61e3af40
y.create.l HWIO_APPS_SMMU_CB27_PMCNTENSE_2_APPS_ADDR A:0x61e3bf40
y.create.l HWIO_APPS_SMMU_CB28_PMCNTENSE_2_APPS_ADDR A:0x61e3cf40
y.create.l HWIO_APPS_SMMU_CB29_PMCNTENSE_2_APPS_ADDR A:0x61e3df40
y.create.l HWIO_APPS_SMMU_CB30_PMCNTENSE_2_APPS_ADDR A:0x61e3ef40
y.create.l HWIO_APPS_SMMU_CB31_PMCNTENSE_2_APPS_ADDR A:0x61e3ff40
y.create.l HWIO_APPS_SMMU_CB0_PMCNTENCLR_2_APPS_ADDR A:0x61e20f44
y.create.l HWIO_APPS_SMMU_CB1_PMCNTENCLR_2_APPS_ADDR A:0x61e21f44
y.create.l HWIO_APPS_SMMU_CB2_PMCNTENCLR_2_APPS_ADDR A:0x61e22f44
y.create.l HWIO_APPS_SMMU_CB3_PMCNTENCLR_2_APPS_ADDR A:0x61e23f44
y.create.l HWIO_APPS_SMMU_CB4_PMCNTENCLR_2_APPS_ADDR A:0x61e24f44
y.create.l HWIO_APPS_SMMU_CB5_PMCNTENCLR_2_APPS_ADDR A:0x61e25f44
y.create.l HWIO_APPS_SMMU_CB6_PMCNTENCLR_2_APPS_ADDR A:0x61e26f44
y.create.l HWIO_APPS_SMMU_CB7_PMCNTENCLR_2_APPS_ADDR A:0x61e27f44
y.create.l HWIO_APPS_SMMU_CB8_PMCNTENCLR_2_APPS_ADDR A:0x61e28f44
y.create.l HWIO_APPS_SMMU_CB9_PMCNTENCLR_2_APPS_ADDR A:0x61e29f44
y.create.l HWIO_APPS_SMMU_CB10_PMCNTENCLR_2_APPS_ADDR A:0x61e2af44
y.create.l HWIO_APPS_SMMU_CB11_PMCNTENCLR_2_APPS_ADDR A:0x61e2bf44
y.create.l HWIO_APPS_SMMU_CB12_PMCNTENCLR_2_APPS_ADDR A:0x61e2cf44
y.create.l HWIO_APPS_SMMU_CB13_PMCNTENCLR_2_APPS_ADDR A:0x61e2df44
y.create.l HWIO_APPS_SMMU_CB14_PMCNTENCLR_2_APPS_ADDR A:0x61e2ef44
y.create.l HWIO_APPS_SMMU_CB15_PMCNTENCLR_2_APPS_ADDR A:0x61e2ff44
y.create.l HWIO_APPS_SMMU_CB16_PMCNTENCLR_2_APPS_ADDR A:0x61e30f44
y.create.l HWIO_APPS_SMMU_CB17_PMCNTENCLR_2_APPS_ADDR A:0x61e31f44
y.create.l HWIO_APPS_SMMU_CB18_PMCNTENCLR_2_APPS_ADDR A:0x61e32f44
y.create.l HWIO_APPS_SMMU_CB19_PMCNTENCLR_2_APPS_ADDR A:0x61e33f44
y.create.l HWIO_APPS_SMMU_CB20_PMCNTENCLR_2_APPS_ADDR A:0x61e34f44
y.create.l HWIO_APPS_SMMU_CB21_PMCNTENCLR_2_APPS_ADDR A:0x61e35f44
y.create.l HWIO_APPS_SMMU_CB22_PMCNTENCLR_2_APPS_ADDR A:0x61e36f44
y.create.l HWIO_APPS_SMMU_CB23_PMCNTENCLR_2_APPS_ADDR A:0x61e37f44
y.create.l HWIO_APPS_SMMU_CB24_PMCNTENCLR_2_APPS_ADDR A:0x61e38f44
y.create.l HWIO_APPS_SMMU_CB25_PMCNTENCLR_2_APPS_ADDR A:0x61e39f44
y.create.l HWIO_APPS_SMMU_CB26_PMCNTENCLR_2_APPS_ADDR A:0x61e3af44
y.create.l HWIO_APPS_SMMU_CB27_PMCNTENCLR_2_APPS_ADDR A:0x61e3bf44
y.create.l HWIO_APPS_SMMU_CB28_PMCNTENCLR_2_APPS_ADDR A:0x61e3cf44
y.create.l HWIO_APPS_SMMU_CB29_PMCNTENCLR_2_APPS_ADDR A:0x61e3df44
y.create.l HWIO_APPS_SMMU_CB30_PMCNTENCLR_2_APPS_ADDR A:0x61e3ef44
y.create.l HWIO_APPS_SMMU_CB31_PMCNTENCLR_2_APPS_ADDR A:0x61e3ff44
y.create.l HWIO_APPS_SMMU_CB0_PMCNTENSET_2_APPS_ADDR A:0x61e20f48
y.create.l HWIO_APPS_SMMU_CB1_PMCNTENSET_2_APPS_ADDR A:0x61e21f48
y.create.l HWIO_APPS_SMMU_CB2_PMCNTENSET_2_APPS_ADDR A:0x61e22f48
y.create.l HWIO_APPS_SMMU_CB3_PMCNTENSET_2_APPS_ADDR A:0x61e23f48
y.create.l HWIO_APPS_SMMU_CB4_PMCNTENSET_2_APPS_ADDR A:0x61e24f48
y.create.l HWIO_APPS_SMMU_CB5_PMCNTENSET_2_APPS_ADDR A:0x61e25f48
y.create.l HWIO_APPS_SMMU_CB6_PMCNTENSET_2_APPS_ADDR A:0x61e26f48
y.create.l HWIO_APPS_SMMU_CB7_PMCNTENSET_2_APPS_ADDR A:0x61e27f48
y.create.l HWIO_APPS_SMMU_CB8_PMCNTENSET_2_APPS_ADDR A:0x61e28f48
y.create.l HWIO_APPS_SMMU_CB9_PMCNTENSET_2_APPS_ADDR A:0x61e29f48
y.create.l HWIO_APPS_SMMU_CB10_PMCNTENSET_2_APPS_ADDR A:0x61e2af48
y.create.l HWIO_APPS_SMMU_CB11_PMCNTENSET_2_APPS_ADDR A:0x61e2bf48
y.create.l HWIO_APPS_SMMU_CB12_PMCNTENSET_2_APPS_ADDR A:0x61e2cf48
y.create.l HWIO_APPS_SMMU_CB13_PMCNTENSET_2_APPS_ADDR A:0x61e2df48
y.create.l HWIO_APPS_SMMU_CB14_PMCNTENSET_2_APPS_ADDR A:0x61e2ef48
y.create.l HWIO_APPS_SMMU_CB15_PMCNTENSET_2_APPS_ADDR A:0x61e2ff48
y.create.l HWIO_APPS_SMMU_CB16_PMCNTENSET_2_APPS_ADDR A:0x61e30f48
y.create.l HWIO_APPS_SMMU_CB17_PMCNTENSET_2_APPS_ADDR A:0x61e31f48
y.create.l HWIO_APPS_SMMU_CB18_PMCNTENSET_2_APPS_ADDR A:0x61e32f48
y.create.l HWIO_APPS_SMMU_CB19_PMCNTENSET_2_APPS_ADDR A:0x61e33f48
y.create.l HWIO_APPS_SMMU_CB20_PMCNTENSET_2_APPS_ADDR A:0x61e34f48
y.create.l HWIO_APPS_SMMU_CB21_PMCNTENSET_2_APPS_ADDR A:0x61e35f48
y.create.l HWIO_APPS_SMMU_CB22_PMCNTENSET_2_APPS_ADDR A:0x61e36f48
y.create.l HWIO_APPS_SMMU_CB23_PMCNTENSET_2_APPS_ADDR A:0x61e37f48
y.create.l HWIO_APPS_SMMU_CB24_PMCNTENSET_2_APPS_ADDR A:0x61e38f48
y.create.l HWIO_APPS_SMMU_CB25_PMCNTENSET_2_APPS_ADDR A:0x61e39f48
y.create.l HWIO_APPS_SMMU_CB26_PMCNTENSET_2_APPS_ADDR A:0x61e3af48
y.create.l HWIO_APPS_SMMU_CB27_PMCNTENSET_2_APPS_ADDR A:0x61e3bf48
y.create.l HWIO_APPS_SMMU_CB28_PMCNTENSET_2_APPS_ADDR A:0x61e3cf48
y.create.l HWIO_APPS_SMMU_CB29_PMCNTENSET_2_APPS_ADDR A:0x61e3df48
y.create.l HWIO_APPS_SMMU_CB30_PMCNTENSET_2_APPS_ADDR A:0x61e3ef48
y.create.l HWIO_APPS_SMMU_CB31_PMCNTENSET_2_APPS_ADDR A:0x61e3ff48
y.create.l HWIO_APPS_SMMU_CB0_PMINTENCLR_2_APPS_ADDR A:0x61e20f4c
y.create.l HWIO_APPS_SMMU_CB1_PMINTENCLR_2_APPS_ADDR A:0x61e21f4c
y.create.l HWIO_APPS_SMMU_CB2_PMINTENCLR_2_APPS_ADDR A:0x61e22f4c
y.create.l HWIO_APPS_SMMU_CB3_PMINTENCLR_2_APPS_ADDR A:0x61e23f4c
y.create.l HWIO_APPS_SMMU_CB4_PMINTENCLR_2_APPS_ADDR A:0x61e24f4c
y.create.l HWIO_APPS_SMMU_CB5_PMINTENCLR_2_APPS_ADDR A:0x61e25f4c
y.create.l HWIO_APPS_SMMU_CB6_PMINTENCLR_2_APPS_ADDR A:0x61e26f4c
y.create.l HWIO_APPS_SMMU_CB7_PMINTENCLR_2_APPS_ADDR A:0x61e27f4c
y.create.l HWIO_APPS_SMMU_CB8_PMINTENCLR_2_APPS_ADDR A:0x61e28f4c
y.create.l HWIO_APPS_SMMU_CB9_PMINTENCLR_2_APPS_ADDR A:0x61e29f4c
y.create.l HWIO_APPS_SMMU_CB10_PMINTENCLR_2_APPS_ADDR A:0x61e2af4c
y.create.l HWIO_APPS_SMMU_CB11_PMINTENCLR_2_APPS_ADDR A:0x61e2bf4c
y.create.l HWIO_APPS_SMMU_CB12_PMINTENCLR_2_APPS_ADDR A:0x61e2cf4c
y.create.l HWIO_APPS_SMMU_CB13_PMINTENCLR_2_APPS_ADDR A:0x61e2df4c
y.create.l HWIO_APPS_SMMU_CB14_PMINTENCLR_2_APPS_ADDR A:0x61e2ef4c
y.create.l HWIO_APPS_SMMU_CB15_PMINTENCLR_2_APPS_ADDR A:0x61e2ff4c
y.create.l HWIO_APPS_SMMU_CB16_PMINTENCLR_2_APPS_ADDR A:0x61e30f4c
y.create.l HWIO_APPS_SMMU_CB17_PMINTENCLR_2_APPS_ADDR A:0x61e31f4c
y.create.l HWIO_APPS_SMMU_CB18_PMINTENCLR_2_APPS_ADDR A:0x61e32f4c
y.create.l HWIO_APPS_SMMU_CB19_PMINTENCLR_2_APPS_ADDR A:0x61e33f4c
y.create.l HWIO_APPS_SMMU_CB20_PMINTENCLR_2_APPS_ADDR A:0x61e34f4c
y.create.l HWIO_APPS_SMMU_CB21_PMINTENCLR_2_APPS_ADDR A:0x61e35f4c
y.create.l HWIO_APPS_SMMU_CB22_PMINTENCLR_2_APPS_ADDR A:0x61e36f4c
y.create.l HWIO_APPS_SMMU_CB23_PMINTENCLR_2_APPS_ADDR A:0x61e37f4c
y.create.l HWIO_APPS_SMMU_CB24_PMINTENCLR_2_APPS_ADDR A:0x61e38f4c
y.create.l HWIO_APPS_SMMU_CB25_PMINTENCLR_2_APPS_ADDR A:0x61e39f4c
y.create.l HWIO_APPS_SMMU_CB26_PMINTENCLR_2_APPS_ADDR A:0x61e3af4c
y.create.l HWIO_APPS_SMMU_CB27_PMINTENCLR_2_APPS_ADDR A:0x61e3bf4c
y.create.l HWIO_APPS_SMMU_CB28_PMINTENCLR_2_APPS_ADDR A:0x61e3cf4c
y.create.l HWIO_APPS_SMMU_CB29_PMINTENCLR_2_APPS_ADDR A:0x61e3df4c
y.create.l HWIO_APPS_SMMU_CB30_PMINTENCLR_2_APPS_ADDR A:0x61e3ef4c
y.create.l HWIO_APPS_SMMU_CB31_PMINTENCLR_2_APPS_ADDR A:0x61e3ff4c
y.create.l HWIO_APPS_SMMU_CB0_PMOVSCLR_2_APPS_ADDR A:0x61e20f50
y.create.l HWIO_APPS_SMMU_CB1_PMOVSCLR_2_APPS_ADDR A:0x61e21f50
y.create.l HWIO_APPS_SMMU_CB2_PMOVSCLR_2_APPS_ADDR A:0x61e22f50
y.create.l HWIO_APPS_SMMU_CB3_PMOVSCLR_2_APPS_ADDR A:0x61e23f50
y.create.l HWIO_APPS_SMMU_CB4_PMOVSCLR_2_APPS_ADDR A:0x61e24f50
y.create.l HWIO_APPS_SMMU_CB5_PMOVSCLR_2_APPS_ADDR A:0x61e25f50
y.create.l HWIO_APPS_SMMU_CB6_PMOVSCLR_2_APPS_ADDR A:0x61e26f50
y.create.l HWIO_APPS_SMMU_CB7_PMOVSCLR_2_APPS_ADDR A:0x61e27f50
y.create.l HWIO_APPS_SMMU_CB8_PMOVSCLR_2_APPS_ADDR A:0x61e28f50
y.create.l HWIO_APPS_SMMU_CB9_PMOVSCLR_2_APPS_ADDR A:0x61e29f50
y.create.l HWIO_APPS_SMMU_CB10_PMOVSCLR_2_APPS_ADDR A:0x61e2af50
y.create.l HWIO_APPS_SMMU_CB11_PMOVSCLR_2_APPS_ADDR A:0x61e2bf50
y.create.l HWIO_APPS_SMMU_CB12_PMOVSCLR_2_APPS_ADDR A:0x61e2cf50
y.create.l HWIO_APPS_SMMU_CB13_PMOVSCLR_2_APPS_ADDR A:0x61e2df50
y.create.l HWIO_APPS_SMMU_CB14_PMOVSCLR_2_APPS_ADDR A:0x61e2ef50
y.create.l HWIO_APPS_SMMU_CB15_PMOVSCLR_2_APPS_ADDR A:0x61e2ff50
y.create.l HWIO_APPS_SMMU_CB16_PMOVSCLR_2_APPS_ADDR A:0x61e30f50
y.create.l HWIO_APPS_SMMU_CB17_PMOVSCLR_2_APPS_ADDR A:0x61e31f50
y.create.l HWIO_APPS_SMMU_CB18_PMOVSCLR_2_APPS_ADDR A:0x61e32f50
y.create.l HWIO_APPS_SMMU_CB19_PMOVSCLR_2_APPS_ADDR A:0x61e33f50
y.create.l HWIO_APPS_SMMU_CB20_PMOVSCLR_2_APPS_ADDR A:0x61e34f50
y.create.l HWIO_APPS_SMMU_CB21_PMOVSCLR_2_APPS_ADDR A:0x61e35f50
y.create.l HWIO_APPS_SMMU_CB22_PMOVSCLR_2_APPS_ADDR A:0x61e36f50
y.create.l HWIO_APPS_SMMU_CB23_PMOVSCLR_2_APPS_ADDR A:0x61e37f50
y.create.l HWIO_APPS_SMMU_CB24_PMOVSCLR_2_APPS_ADDR A:0x61e38f50
y.create.l HWIO_APPS_SMMU_CB25_PMOVSCLR_2_APPS_ADDR A:0x61e39f50
y.create.l HWIO_APPS_SMMU_CB26_PMOVSCLR_2_APPS_ADDR A:0x61e3af50
y.create.l HWIO_APPS_SMMU_CB27_PMOVSCLR_2_APPS_ADDR A:0x61e3bf50
y.create.l HWIO_APPS_SMMU_CB28_PMOVSCLR_2_APPS_ADDR A:0x61e3cf50
y.create.l HWIO_APPS_SMMU_CB29_PMOVSCLR_2_APPS_ADDR A:0x61e3df50
y.create.l HWIO_APPS_SMMU_CB30_PMOVSCLR_2_APPS_ADDR A:0x61e3ef50
y.create.l HWIO_APPS_SMMU_CB31_PMOVSCLR_2_APPS_ADDR A:0x61e3ff50
y.create.l HWIO_APPS_SMMU_CB0_PMOVSSET_2_APPS_ADDR A:0x61e20f58
y.create.l HWIO_APPS_SMMU_CB1_PMOVSSET_2_APPS_ADDR A:0x61e21f58
y.create.l HWIO_APPS_SMMU_CB2_PMOVSSET_2_APPS_ADDR A:0x61e22f58
y.create.l HWIO_APPS_SMMU_CB3_PMOVSSET_2_APPS_ADDR A:0x61e23f58
y.create.l HWIO_APPS_SMMU_CB4_PMOVSSET_2_APPS_ADDR A:0x61e24f58
y.create.l HWIO_APPS_SMMU_CB5_PMOVSSET_2_APPS_ADDR A:0x61e25f58
y.create.l HWIO_APPS_SMMU_CB6_PMOVSSET_2_APPS_ADDR A:0x61e26f58
y.create.l HWIO_APPS_SMMU_CB7_PMOVSSET_2_APPS_ADDR A:0x61e27f58
y.create.l HWIO_APPS_SMMU_CB8_PMOVSSET_2_APPS_ADDR A:0x61e28f58
y.create.l HWIO_APPS_SMMU_CB9_PMOVSSET_2_APPS_ADDR A:0x61e29f58
y.create.l HWIO_APPS_SMMU_CB10_PMOVSSET_2_APPS_ADDR A:0x61e2af58
y.create.l HWIO_APPS_SMMU_CB11_PMOVSSET_2_APPS_ADDR A:0x61e2bf58
y.create.l HWIO_APPS_SMMU_CB12_PMOVSSET_2_APPS_ADDR A:0x61e2cf58
y.create.l HWIO_APPS_SMMU_CB13_PMOVSSET_2_APPS_ADDR A:0x61e2df58
y.create.l HWIO_APPS_SMMU_CB14_PMOVSSET_2_APPS_ADDR A:0x61e2ef58
y.create.l HWIO_APPS_SMMU_CB15_PMOVSSET_2_APPS_ADDR A:0x61e2ff58
y.create.l HWIO_APPS_SMMU_CB16_PMOVSSET_2_APPS_ADDR A:0x61e30f58
y.create.l HWIO_APPS_SMMU_CB17_PMOVSSET_2_APPS_ADDR A:0x61e31f58
y.create.l HWIO_APPS_SMMU_CB18_PMOVSSET_2_APPS_ADDR A:0x61e32f58
y.create.l HWIO_APPS_SMMU_CB19_PMOVSSET_2_APPS_ADDR A:0x61e33f58
y.create.l HWIO_APPS_SMMU_CB20_PMOVSSET_2_APPS_ADDR A:0x61e34f58
y.create.l HWIO_APPS_SMMU_CB21_PMOVSSET_2_APPS_ADDR A:0x61e35f58
y.create.l HWIO_APPS_SMMU_CB22_PMOVSSET_2_APPS_ADDR A:0x61e36f58
y.create.l HWIO_APPS_SMMU_CB23_PMOVSSET_2_APPS_ADDR A:0x61e37f58
y.create.l HWIO_APPS_SMMU_CB24_PMOVSSET_2_APPS_ADDR A:0x61e38f58
y.create.l HWIO_APPS_SMMU_CB25_PMOVSSET_2_APPS_ADDR A:0x61e39f58
y.create.l HWIO_APPS_SMMU_CB26_PMOVSSET_2_APPS_ADDR A:0x61e3af58
y.create.l HWIO_APPS_SMMU_CB27_PMOVSSET_2_APPS_ADDR A:0x61e3bf58
y.create.l HWIO_APPS_SMMU_CB28_PMOVSSET_2_APPS_ADDR A:0x61e3cf58
y.create.l HWIO_APPS_SMMU_CB29_PMOVSSET_2_APPS_ADDR A:0x61e3df58
y.create.l HWIO_APPS_SMMU_CB30_PMOVSSET_2_APPS_ADDR A:0x61e3ef58
y.create.l HWIO_APPS_SMMU_CB31_PMOVSSET_2_APPS_ADDR A:0x61e3ff58
y.create.l HWIO_APPS_SMMU_CB0_PMAUTHSTATUS_2_APPS_ADDR A:0x61e20fb8
y.create.l HWIO_APPS_SMMU_CB1_PMAUTHSTATUS_2_APPS_ADDR A:0x61e21fb8
y.create.l HWIO_APPS_SMMU_CB2_PMAUTHSTATUS_2_APPS_ADDR A:0x61e22fb8
y.create.l HWIO_APPS_SMMU_CB3_PMAUTHSTATUS_2_APPS_ADDR A:0x61e23fb8
y.create.l HWIO_APPS_SMMU_CB4_PMAUTHSTATUS_2_APPS_ADDR A:0x61e24fb8
y.create.l HWIO_APPS_SMMU_CB5_PMAUTHSTATUS_2_APPS_ADDR A:0x61e25fb8
y.create.l HWIO_APPS_SMMU_CB6_PMAUTHSTATUS_2_APPS_ADDR A:0x61e26fb8
y.create.l HWIO_APPS_SMMU_CB7_PMAUTHSTATUS_2_APPS_ADDR A:0x61e27fb8
y.create.l HWIO_APPS_SMMU_CB8_PMAUTHSTATUS_2_APPS_ADDR A:0x61e28fb8
y.create.l HWIO_APPS_SMMU_CB9_PMAUTHSTATUS_2_APPS_ADDR A:0x61e29fb8
y.create.l HWIO_APPS_SMMU_CB10_PMAUTHSTATUS_2_APPS_ADDR A:0x61e2afb8
y.create.l HWIO_APPS_SMMU_CB11_PMAUTHSTATUS_2_APPS_ADDR A:0x61e2bfb8
y.create.l HWIO_APPS_SMMU_CB12_PMAUTHSTATUS_2_APPS_ADDR A:0x61e2cfb8
y.create.l HWIO_APPS_SMMU_CB13_PMAUTHSTATUS_2_APPS_ADDR A:0x61e2dfb8
y.create.l HWIO_APPS_SMMU_CB14_PMAUTHSTATUS_2_APPS_ADDR A:0x61e2efb8
y.create.l HWIO_APPS_SMMU_CB15_PMAUTHSTATUS_2_APPS_ADDR A:0x61e2ffb8
y.create.l HWIO_APPS_SMMU_CB16_PMAUTHSTATUS_2_APPS_ADDR A:0x61e30fb8
y.create.l HWIO_APPS_SMMU_CB17_PMAUTHSTATUS_2_APPS_ADDR A:0x61e31fb8
y.create.l HWIO_APPS_SMMU_CB18_PMAUTHSTATUS_2_APPS_ADDR A:0x61e32fb8
y.create.l HWIO_APPS_SMMU_CB19_PMAUTHSTATUS_2_APPS_ADDR A:0x61e33fb8
y.create.l HWIO_APPS_SMMU_CB20_PMAUTHSTATUS_2_APPS_ADDR A:0x61e34fb8
y.create.l HWIO_APPS_SMMU_CB21_PMAUTHSTATUS_2_APPS_ADDR A:0x61e35fb8
y.create.l HWIO_APPS_SMMU_CB22_PMAUTHSTATUS_2_APPS_ADDR A:0x61e36fb8
y.create.l HWIO_APPS_SMMU_CB23_PMAUTHSTATUS_2_APPS_ADDR A:0x61e37fb8
y.create.l HWIO_APPS_SMMU_CB24_PMAUTHSTATUS_2_APPS_ADDR A:0x61e38fb8
y.create.l HWIO_APPS_SMMU_CB25_PMAUTHSTATUS_2_APPS_ADDR A:0x61e39fb8
y.create.l HWIO_APPS_SMMU_CB26_PMAUTHSTATUS_2_APPS_ADDR A:0x61e3afb8
y.create.l HWIO_APPS_SMMU_CB27_PMAUTHSTATUS_2_APPS_ADDR A:0x61e3bfb8
y.create.l HWIO_APPS_SMMU_CB28_PMAUTHSTATUS_2_APPS_ADDR A:0x61e3cfb8
y.create.l HWIO_APPS_SMMU_CB29_PMAUTHSTATUS_2_APPS_ADDR A:0x61e3dfb8
y.create.l HWIO_APPS_SMMU_CB30_PMAUTHSTATUS_2_APPS_ADDR A:0x61e3efb8
y.create.l HWIO_APPS_SMMU_CB31_PMAUTHSTATUS_2_APPS_ADDR A:0x61e3ffb8
y.create.l HWIO_SMMU_INTR_SEL_SEC_ADDR A:0x61ef0000
y.create.l HWIO_SMMU_MISC_TIE_OFF_SEC_ADDR A:0x61ef0008
y.create.l HWIO_SMMU_CATS_64_BIT_CTL_SEC_ADDR A:0x61ef0010
y.create.l HWIO_SMMU_CATS_128_BIT_CTL_SEC_ADDR A:0x61ef0018
y.create.l HWIO_SMMU_APP_TCU_PTW_VMID_SEC_ADDR A:0x61ef0020
y.create.l HWIO_SMMU_GFX_TCU_PTW_VMID_SEC_ADDR A:0x61ef0028
y.create.l HWIO_SMMU_SPARE_REG_1_SEC_ADDR A:0x61ef0030
y.create.l HWIO_SMMU_INTR_SEL_NSHYP_ADDR A:0x61ef1000
y.create.l HWIO_SMMU_GFX_AHB_4K_APERTURE_NSHYP_ADDR A:0x61ef1008
y.create.l HWIO_SMMU_MSA_BYPASS_ERR_ADDR_NSHYP_ADDR A:0x61ef1010
y.create.l HWIO_SMMU_MSA_BYPASS_INTR_EN_NSHYP_ADDR A:0x61ef1018
y.create.l HWIO_SMMU_MSA_BYPASS_INTR_STTS_NSHYP_ADDR A:0x61ef1020
y.create.l HWIO_SMMU_MSA_BYPASS_INTR_CLR_NSHYP_ADDR A:0x61ef1028
y.create.l HWIO_SMMU_INTR_SEL_NS_ADDR A:0x61ef2000
y.create.l HWIO_SMMU_TESTBUS_SEL_NS_ADDR A:0x61ef2008
y.create.l HWIO_SMMU_HW_INFO_NS_ADDR A:0x61ef2010
y.create.l HWIO_SMMU_HW_VERSION_NS_ADDR A:0x61ef2018
y.create.l HWIO_SMMU_MODEM_TBU_VA_PA_MATCH_MSA_ADDR A:0x61ef3000
y.create.l HWIO_SMMU_SID2VMID_SMR_VFE_0_ADDR A:0x61ef4000
y.create.l HWIO_SMMU_SID2VMID_SMR_VFE_1_ADDR A:0x61ef4008
y.create.l HWIO_SMMU_SID2VMID_SMR_VFE_2_ADDR A:0x61ef4010
y.create.l HWIO_SMMU_SID2VMID_SMR_VFE_3_ADDR A:0x61ef4018
y.create.l HWIO_SMMU_SID2VMID_FAULT_VMID_VFE_ADDR A:0x61ef4020
y.create.l HWIO_SMMU_SID2VMID_FAULT_INTR_EN_VFE_ADDR A:0x61ef4028
y.create.l HWIO_SMMU_SID2VMID_FAULT_INTR_STTS_VFE_ADDR A:0x61ef4030
y.create.l HWIO_SMMU_SID2VMID_FAULT_INTR_CLR_VFE_ADDR A:0x61ef4038
y.create.l HWIO_SMMU_PWR_CTRL_VFE_REQ_ADDR A:0x61ef4040
y.create.l HWIO_SMMU_PWR_CTRL_VFE_ACK_ADDR A:0x61ef4048
y.create.l HWIO_SMMU_SID2VMID_SMR_MDP_0_ADDR A:0x61ef5000
y.create.l HWIO_SMMU_SID2VMID_SMR_MDP_1_ADDR A:0x61ef5008
y.create.l HWIO_SMMU_SID2VMID_FAULT_VMID_MDP_ADDR A:0x61ef5010
y.create.l HWIO_SMMU_SID2VMID_FAULT_INTR_EN_MDP_ADDR A:0x61ef5018
y.create.l HWIO_SMMU_SID2VMID_FAULT_INTR_STTS_MDP_ADDR A:0x61ef5020
y.create.l HWIO_SMMU_SID2VMID_FAULT_INTR_CLR_MDP_ADDR A:0x61ef5028
y.create.l HWIO_SMMU_PWR_CTRL_MDP_REQ_ADDR A:0x61ef5030
y.create.l HWIO_SMMU_PWR_CTRL_MDP_ACK_ADDR A:0x61ef5038
y.create.l HWIO_SMMU_SID2VMID_SMR_VENUS_0_ADDR A:0x61ef6000
y.create.l HWIO_SMMU_SID2VMID_SMR_VENUS_1_ADDR A:0x61ef6008
y.create.l HWIO_SMMU_SID2VMID_SMR_VENUS_2_ADDR A:0x61ef6010
y.create.l HWIO_SMMU_SID2VMID_SMR_VENUS_3_ADDR A:0x61ef6018
y.create.l HWIO_SMMU_SID2VMID_SMR_VENUS_4_ADDR A:0x61ef6020
y.create.l HWIO_SMMU_SID2VMID_SMR_VENUS_5_ADDR A:0x61ef6028
y.create.l HWIO_SMMU_SID2VMID_SMR_VENUS_6_ADDR A:0x61ef6030
y.create.l HWIO_SMMU_SID2VMID_SMR_VENUS_7_ADDR A:0x61ef6038
y.create.l HWIO_SMMU_SID2VMID_SMR_VENUS_8_ADDR A:0x61ef6040
y.create.l HWIO_SMMU_SID2VMID_SMR_VENUS_9_ADDR A:0x61ef6048
y.create.l HWIO_SMMU_SID2VMID_FAULT_VMID_VENUS_ADDR A:0x61ef6090
y.create.l HWIO_SMMU_SID2VMID_FAULT_INTR_EN_VENUS_ADDR A:0x61ef6098
y.create.l HWIO_SMMU_SID2VMID_FAULT_INTR_STTS_VENUS_ADDR A:0x61ef60a0
y.create.l HWIO_SMMU_SID2VMID_FAULT_INTR_CLR_VENUS_ADDR A:0x61ef60a8
y.create.l HWIO_SMMU_PWR_CTRL_VENUS_REQ_ADDR A:0x61ef60b0
y.create.l HWIO_SMMU_PWR_CTRL_VENUS_ACK_ADDR A:0x61ef60b8
y.create.l HWIO_SMMU_SID2VMID_SMR_PRONTO_0_ADDR A:0x61ef7000
y.create.l HWIO_SMMU_SID2VMID_SMR_PRONTO_1_ADDR A:0x61ef7008
y.create.l HWIO_SMMU_SID2VMID_SMR_PRONTO_2_ADDR A:0x61ef7010
y.create.l HWIO_SMMU_SID2VMID_SMR_PRONTO_3_ADDR A:0x61ef7018
y.create.l HWIO_SMMU_SID2VMID_SMR_PRONTO_4_ADDR A:0x61ef7020
y.create.l HWIO_SMMU_SID2VMID_SMR_PRONTO_5_ADDR A:0x61ef7028
y.create.l HWIO_SMMU_SID2VMID_SMR_PRONTO_6_ADDR A:0x61ef7030
y.create.l HWIO_SMMU_SID2VMID_SMR_PRONTO_7_ADDR A:0x61ef7038
y.create.l HWIO_SMMU_SID2VMID_SMR_PRONTO_8_ADDR A:0x61ef7040
y.create.l HWIO_SMMU_SID2VMID_SMR_PRONTO_9_ADDR A:0x61ef7048
y.create.l HWIO_SMMU_SID2VMID_FAULT_VMID_PRONTO_ADDR A:0x61ef7068
y.create.l HWIO_SMMU_SID2VMID_FAULT_INTR_EN_PRONTO_ADDR A:0x61ef7070
y.create.l HWIO_SMMU_SID2VMID_FAULT_INTR_STTS_PRONTO_ADDR A:0x61ef7078
y.create.l HWIO_SMMU_SID2VMID_FAULT_INTR_CLR_PRONTO_ADDR A:0x61ef7080
y.create.l HWIO_SMMU_PWR_CTRL_PRONTO_REQ_ADDR A:0x61ef7088
y.create.l HWIO_SMMU_PWR_CTRL_PRONTO_ACK_ADDR A:0x61ef7090
y.create.l HWIO_SMMU_SID2VMID_SMR_PERIPH_0_ADDR A:0x61ef8000
y.create.l HWIO_SMMU_SID2VMID_SMR_PERIPH_1_ADDR A:0x61ef8008
y.create.l HWIO_SMMU_SID2VMID_SMR_PERIPH_2_ADDR A:0x61ef8010
y.create.l HWIO_SMMU_SID2VMID_SMR_PERIPH_3_ADDR A:0x61ef8018
y.create.l HWIO_SMMU_SID2VMID_SMR_PERIPH_4_ADDR A:0x61ef8020
y.create.l HWIO_SMMU_SID2VMID_SMR_PERIPH_5_ADDR A:0x61ef8028
y.create.l HWIO_SMMU_SID2VMID_SMR_PERIPH_6_ADDR A:0x61ef8030
y.create.l HWIO_SMMU_SID2VMID_SMR_PERIPH_7_ADDR A:0x61ef8038
y.create.l HWIO_SMMU_SID2VMID_SMR_PERIPH_8_ADDR A:0x61ef8040
y.create.l HWIO_SMMU_SID2VMID_SMR_PERIPH_9_ADDR A:0x61ef8048
y.create.l HWIO_SMMU_SID2VMID_FAULT_VMID_PERIPH_ADDR A:0x61ef8178
y.create.l HWIO_SMMU_SID2VMID_FAULT_INTR_EN_PERIPH_ADDR A:0x61ef8180
y.create.l HWIO_SMMU_SID2VMID_FAULT_INTR_STTS_PERIPH_ADDR A:0x61ef8188
y.create.l HWIO_SMMU_SID2VMID_FAULT_INTR_CLR_PERIPH_ADDR A:0x61ef8190
y.create.l HWIO_SMMU_PWR_CTRL_PERIPH_REQ_ADDR A:0x61ef8198
y.create.l HWIO_SMMU_PWR_CTRL_PERIPH_ACK_ADDR A:0x61ef81a0
y.create.l HWIO_SMMU_SID2VMID_SMR_DIME_0_ADDR A:0x61ef9000
y.create.l HWIO_SMMU_SID2VMID_SMR_DIME_1_ADDR A:0x61ef9008
y.create.l HWIO_SMMU_SID2VMID_FAULT_VMID_DIME_ADDR A:0x61ef9010
y.create.l HWIO_SMMU_SID2VMID_FAULT_INTR_EN_DIME_ADDR A:0x61ef9018
y.create.l HWIO_SMMU_SID2VMID_FAULT_INTR_STTS_DIME_ADDR A:0x61ef9020
y.create.l HWIO_SMMU_SID2VMID_FAULT_INTR_CLR_DIME_ADDR A:0x61ef9028
y.create.l HWIO_SMMU_PWR_CTRL_DIME_REQ_ADDR A:0x61ef9030
y.create.l HWIO_SMMU_PWR_CTRL_DIME_ACK_ADDR A:0x61ef9038
y.create.l HWIO_SMMU_SID2VMID_SMR_GPS_0_ADDR A:0x61efa000
y.create.l HWIO_SMMU_SID2VMID_SMR_GPS_1_ADDR A:0x61efa008
y.create.l HWIO_SMMU_SID2VMID_FAULT_VMID_GPS_ADDR A:0x61efa010
y.create.l HWIO_SMMU_SID2VMID_FAULT_INTR_EN_GPS_ADDR A:0x61efa018
y.create.l HWIO_SMMU_SID2VMID_FAULT_INTR_STTS_GPS_ADDR A:0x61efa020
y.create.l HWIO_SMMU_SID2VMID_FAULT_INTR_CLR_GPS_ADDR A:0x61efa028
y.create.l HWIO_SMMU_PWR_CTRL_GPS_REQ_ADDR A:0x61efa030
y.create.l HWIO_SMMU_PWR_CTRL_GPS_ACK_ADDR A:0x61efa038
y.create.l HWIO_SMMU_SID2VMID_SMR_QDSP_0_ADDR A:0x61efb000
y.create.l HWIO_SMMU_SID2VMID_SMR_QDSP_1_ADDR A:0x61efb008
y.create.l HWIO_SMMU_SID2VMID_SMR_QDSP_2_ADDR A:0x61efb010
y.create.l HWIO_SMMU_SID2VMID_SMR_QDSP_3_ADDR A:0x61efb018
y.create.l HWIO_SMMU_SID2VMID_FAULT_VMID_QDSP_ADDR A:0x61efb020
y.create.l HWIO_SMMU_SID2VMID_FAULT_INTR_EN_QDSP_ADDR A:0x61efb028
y.create.l HWIO_SMMU_SID2VMID_FAULT_INTR_STTS_QDSP_ADDR A:0x61efb030
y.create.l HWIO_SMMU_SID2VMID_FAULT_INTR_CLR_QDSP_ADDR A:0x61efb038
y.create.l HWIO_SMMU_PWR_CTRL_QDSP_REQ_ADDR A:0x61efb040
y.create.l HWIO_SMMU_PWR_CTRL_QDSP_ACK_ADDR A:0x61efb048
y.create.l HWIO_SMMU_SID2VMID_SMR_GFX_0_ADDR A:0x61efc000
y.create.l HWIO_SMMU_SID2VMID_SMR_GFX_1_ADDR A:0x61efc008
y.create.l HWIO_SMMU_SID2VMID_FAULT_VMID_GFX_ADDR A:0x61efc010
y.create.l HWIO_SMMU_SID2VMID_FAULT_INTR_EN_GFX_ADDR A:0x61efc018
y.create.l HWIO_SMMU_SID2VMID_FAULT_INTR_STTS_GFX_ADDR A:0x61efc020
y.create.l HWIO_SMMU_SID2VMID_FAULT_INTR_CLR_GFX_ADDR A:0x61efc028
y.create.l HWIO_SMMU_PWR_CTRL_GFX_REQ_ADDR A:0x61efc030
y.create.l HWIO_SMMU_PWR_CTRL_GFX_ACK_ADDR A:0x61efc038
y.create.l HWIO_GFX_SMMU_SCR0_GFX_ADDR A:0x61f00000
y.create.l HWIO_GFX_SMMU_NSCR0_GFX_ADDR A:0x61f00400
y.create.l HWIO_GFX_SMMU_SCR1_GFX_ADDR A:0x61f00004
y.create.l HWIO_GFX_SMMU_SACR_GFX_ADDR A:0x61f00010
y.create.l HWIO_GFX_SMMU_NSACR_GFX_ADDR A:0x61f00410
y.create.l HWIO_GFX_SMMU_SIDR0_GFX_ADDR A:0x61f00020
y.create.l HWIO_GFX_SMMU_SIDR1_GFX_ADDR A:0x61f00024
y.create.l HWIO_GFX_SMMU_SIDR2_GFX_ADDR A:0x61f00028
y.create.l HWIO_GFX_SMMU_SIDR7_GFX_ADDR A:0x61f0003c
y.create.l HWIO_GFX_SMMU_SGFAR_LOW_GFX_ADDR A:0x61f00040
y.create.l HWIO_GFX_SMMU_SGFAR_HIGH_GFX_ADDR A:0x61f00044
y.create.l HWIO_GFX_SMMU_NSGFAR_LOW_GFX_ADDR A:0x61f00440
y.create.l HWIO_GFX_SMMU_NSGFAR_HIGH_GFX_ADDR A:0x61f00444
y.create.l HWIO_GFX_SMMU_SGFSR_GFX_ADDR A:0x61f00048
y.create.l HWIO_GFX_SMMU_NSGFSR_GFX_ADDR A:0x61f00448
y.create.l HWIO_GFX_SMMU_SGFSRRESTORE_GFX_ADDR A:0x61f0004c
y.create.l HWIO_GFX_SMMU_NSGFSRRESTORE_GFX_ADDR A:0x61f0044c
y.create.l HWIO_GFX_SMMU_SGFSYNR0_GFX_ADDR A:0x61f00050
y.create.l HWIO_GFX_SMMU_NSGFSYNR0_GFX_ADDR A:0x61f00450
y.create.l HWIO_GFX_SMMU_SGFSYNR1_GFX_ADDR A:0x61f00054
y.create.l HWIO_GFX_SMMU_NSGFSYNDR1_GFX_ADDR A:0x61f00454
y.create.l HWIO_GFX_SMMU_STLBIALL_GFX_ADDR A:0x61f00060
y.create.l HWIO_GFX_SMMU_TLBIVMID_GFX_ADDR A:0x61f00064
y.create.l HWIO_GFX_SMMU_TLBIALLNSNH_GFX_ADDR A:0x61f00068
y.create.l HWIO_GFX_SMMU_NSTLBGSYNC_GFX_ADDR A:0x61f00470
y.create.l HWIO_GFX_SMMU_STLBGSYNC_GFX_ADDR A:0x61f00070
y.create.l HWIO_GFX_SMMU_STLBGSTATUS_GFX_ADDR A:0x61f00074
y.create.l HWIO_GFX_SMMU_NSTLBGSTATUS_GFX_ADDR A:0x61f00474
y.create.l HWIO_GFX_SMMU_DBGRPTRTBU_GFX_ADDR A:0x61f00080
y.create.l HWIO_GFX_SMMU_DBGRDATATBU_GFX_ADDR A:0x61f00084
y.create.l HWIO_GFX_SMMU_DBGRPTRTCU_GFX_ADDR A:0x61f00088
y.create.l HWIO_GFX_SMMU_DBGRDATATCU_GFX_ADDR A:0x61f0008c
y.create.l HWIO_GFX_SMMU_STLBIVALM_LOW_GFX_ADDR A:0x61f000a0
y.create.l HWIO_GFX_SMMU_STLBIVALM_HIGH_GFX_ADDR A:0x61f000a4
y.create.l HWIO_GFX_SMMU_STLBIVAM_LOW_GFX_ADDR A:0x61f000a8
y.create.l HWIO_GFX_SMMU_STLBIVAM_HIGH_GFX_ADDR A:0x61f000ac
y.create.l HWIO_GFX_SMMU_STLBIALLM_GFX_ADDR A:0x61f000bc
y.create.l HWIO_GFX_SMMU_SMR0_GFX_ADDR A:0x61f00800
y.create.l HWIO_GFX_SMMU_SMR1_GFX_ADDR A:0x61f00804
y.create.l HWIO_GFX_SMMU_SMR2_GFX_ADDR A:0x61f00808
y.create.l HWIO_GFX_SMMU_SMR3_GFX_ADDR A:0x61f0080c
y.create.l HWIO_GFX_SMMU_S2CR0_GFX_ADDR A:0x61f00c00
y.create.l HWIO_GFX_SMMU_S2CR1_GFX_ADDR A:0x61f00c04
y.create.l HWIO_GFX_SMMU_S2CR2_GFX_ADDR A:0x61f00c08
y.create.l HWIO_GFX_SMMU_S2CR3_GFX_ADDR A:0x61f00c0c
y.create.l HWIO_GFX_SMMU_PIDR0_GFX_ADDR A:0x61f00fe0
y.create.l HWIO_GFX_SMMU_PIDR1_GFX_ADDR A:0x61f00fe4
y.create.l HWIO_GFX_SMMU_PIDR2_GFX_ADDR A:0x61f00fe8
y.create.l HWIO_GFX_SMMU_PIDR3_GFX_ADDR A:0x61f00fec
y.create.l HWIO_GFX_SMMU_PIDR4_GFX_ADDR A:0x61f00fd0
y.create.l HWIO_GFX_SMMU_PIDR5_GFX_ADDR A:0x61f00fd4
y.create.l HWIO_GFX_SMMU_PIDR6_GFX_ADDR A:0x61f00fd8
y.create.l HWIO_GFX_SMMU_PIDR7_GFX_ADDR A:0x61f00fdc
y.create.l HWIO_GFX_SMMU_CIDR0_GFX_ADDR A:0x61f00ff0
y.create.l HWIO_GFX_SMMU_CIDR1_GFX_ADDR A:0x61f00ff4
y.create.l HWIO_GFX_SMMU_CIDR2_GFX_ADDR A:0x61f00ff8
y.create.l HWIO_GFX_SMMU_CIDR3_GFX_ADDR A:0x61f00ffc
y.create.l HWIO_GFX_SMMU_CBAR0_GFX_ADDR A:0x61f01000
y.create.l HWIO_GFX_SMMU_CBFRSYNRA0_GFX_ADDR A:0x61f01400
y.create.l HWIO_GFX_SMMU_CBA2R0_GFX_ADDR A:0x61f01800
y.create.l HWIO_GFX_SMMU_CBAR1_GFX_ADDR A:0x61f01004
y.create.l HWIO_GFX_SMMU_CBFRSYNRA1_GFX_ADDR A:0x61f01404
y.create.l HWIO_GFX_SMMU_CBA2R1_GFX_ADDR A:0x61f01804
y.create.l HWIO_GFX_SMMU_CBAR2_GFX_ADDR A:0x61f01008
y.create.l HWIO_GFX_SMMU_CBFRSYNRA2_GFX_ADDR A:0x61f01408
y.create.l HWIO_GFX_SMMU_CBA2R2_GFX_ADDR A:0x61f01808
y.create.l HWIO_GFX_SMMU_CBAR3_GFX_ADDR A:0x61f0100c
y.create.l HWIO_GFX_SMMU_CBFRSYNRA3_GFX_ADDR A:0x61f0140c
y.create.l HWIO_GFX_SMMU_CBA2R3_GFX_ADDR A:0x61f0180c
y.create.l HWIO_GFX_SMMU_ITCTRL_GFX_ADDR A:0x61f02000
y.create.l HWIO_GFX_SMMU_ITIP_GFX_ADDR A:0x61f02004
y.create.l HWIO_GFX_SMMU_ITOP_GLBL_GFX_ADDR A:0x61f02008
y.create.l HWIO_GFX_SMMU_ITOP_PERF_INDEX_GFX_ADDR A:0x61f0200c
y.create.l HWIO_GFX_SMMU_ITOP_CXT0TO31_RAM0_GFX_ADDR A:0x61f02010
y.create.l HWIO_GFX_SMMU_TBUQOS0_GFX_ADDR A:0x61f02100
y.create.l HWIO_GFX_SMMU_PER_GFX_ADDR A:0x61f02200
y.create.l HWIO_GFX_SMMU_TBU_PWR_STATUS_GFX_ADDR A:0x61f02204
y.create.l HWIO_GFX_PMEVCNTR0_GFX_ADDR A:0x61f03000
y.create.l HWIO_GFX_PMEVCNTR1_GFX_ADDR A:0x61f03004
y.create.l HWIO_GFX_PMEVCNTR2_GFX_ADDR A:0x61f03008
y.create.l HWIO_GFX_PMEVCNTR3_GFX_ADDR A:0x61f0300c
y.create.l HWIO_GFX_PMEVTYPER0_GFX_ADDR A:0x61f03400
y.create.l HWIO_GFX_PMEVTYPER1_GFX_ADDR A:0x61f03404
y.create.l HWIO_GFX_PMEVTYPER2_GFX_ADDR A:0x61f03408
y.create.l HWIO_GFX_PMEVTYPER3_GFX_ADDR A:0x61f0340c
y.create.l HWIO_GFX_PMCGCR_GFX_ADDR A:0x61f03800
y.create.l HWIO_GFX_PMCGSMR_GFX_ADDR A:0x61f03a00
y.create.l HWIO_GFX_PMCNTENSET_GFX_ADDR A:0x61f03c00
y.create.l HWIO_GFX_PMCNTENCLR_GFX_ADDR A:0x61f03c20
y.create.l HWIO_GFX_PMINTENSET_GFX_ADDR A:0x61f03c40
y.create.l HWIO_GFX_PMINTENCLR_GFX_ADDR A:0x61f03c60
y.create.l HWIO_GFX_PMOVSCLR_GFX_ADDR A:0x61f03c80
y.create.l HWIO_GFX_PMOVSSET_GFX_ADDR A:0x61f03cc0
y.create.l HWIO_GFX_PMCFGR_GFX_ADDR A:0x61f03e00
y.create.l HWIO_GFX_PMCR_GFX_ADDR A:0x61f03e04
y.create.l HWIO_GFX_PMCEID0_GFX_ADDR A:0x61f03e20
y.create.l HWIO_GFX_PMAUTHSTATUS_GFX_ADDR A:0x61f03fb8
y.create.l HWIO_GFX_PMDEVTYPE_GFX_ADDR A:0x61f03fcc
y.create.l HWIO_GFX_SMMU_CB0_SCTLR_GFX_ADDR A:0x61f08000
y.create.l HWIO_GFX_SMMU_CB1_SCTLR_GFX_ADDR A:0x61f09000
y.create.l HWIO_GFX_SMMU_CB2_SCTLR_GFX_ADDR A:0x61f0a000
y.create.l HWIO_GFX_SMMU_CB3_SCTLR_GFX_ADDR A:0x61f0b000
y.create.l HWIO_GFX_SMMU_CB0_ACTLR_GFX_ADDR A:0x61f08004
y.create.l HWIO_GFX_SMMU_CB1_ACTLR_GFX_ADDR A:0x61f09004
y.create.l HWIO_GFX_SMMU_CB2_ACTLR_GFX_ADDR A:0x61f0a004
y.create.l HWIO_GFX_SMMU_CB3_ACTLR_GFX_ADDR A:0x61f0b004
y.create.l HWIO_GFX_SMMU_CB0_RESUME_GFX_ADDR A:0x61f08008
y.create.l HWIO_GFX_SMMU_CB1_RESUME_GFX_ADDR A:0x61f09008
y.create.l HWIO_GFX_SMMU_CB2_RESUME_GFX_ADDR A:0x61f0a008
y.create.l HWIO_GFX_SMMU_CB3_RESUME_GFX_ADDR A:0x61f0b008
y.create.l HWIO_GFX_SMMU_CB0_TCR2_GFX_ADDR A:0x61f08010
y.create.l HWIO_GFX_SMMU_CB1_TCR2_GFX_ADDR A:0x61f09010
y.create.l HWIO_GFX_SMMU_CB2_TCR2_GFX_ADDR A:0x61f0a010
y.create.l HWIO_GFX_SMMU_CB3_TCR2_GFX_ADDR A:0x61f0b010
y.create.l HWIO_GFX_SMMU_CB0_TTBR0_LOW_GFX_ADDR A:0x61f08020
y.create.l HWIO_GFX_SMMU_CB1_TTBR0_LOW_GFX_ADDR A:0x61f09020
y.create.l HWIO_GFX_SMMU_CB2_TTBR0_LOW_GFX_ADDR A:0x61f0a020
y.create.l HWIO_GFX_SMMU_CB3_TTBR0_LOW_GFX_ADDR A:0x61f0b020
y.create.l HWIO_GFX_SMMU_CB0_TTBR0_HIGH_GFX_ADDR A:0x61f08024
y.create.l HWIO_GFX_SMMU_CB1_TTBR0_HIGH_GFX_ADDR A:0x61f09024
y.create.l HWIO_GFX_SMMU_CB2_TTBR0_HIGH_GFX_ADDR A:0x61f0a024
y.create.l HWIO_GFX_SMMU_CB3_TTBR0_HIGH_GFX_ADDR A:0x61f0b024
y.create.l HWIO_GFX_SMMU_CB0_TTBR1_LOW_GFX_ADDR A:0x61f08028
y.create.l HWIO_GFX_SMMU_CB1_TTBR1_LOW_GFX_ADDR A:0x61f09028
y.create.l HWIO_GFX_SMMU_CB2_TTBR1_LOW_GFX_ADDR A:0x61f0a028
y.create.l HWIO_GFX_SMMU_CB3_TTBR1_LOW_GFX_ADDR A:0x61f0b028
y.create.l HWIO_GFX_SMMU_CB0_TTBR1_HIGH_GFX_ADDR A:0x61f0802c
y.create.l HWIO_GFX_SMMU_CB1_TTBR1_HIGH_GFX_ADDR A:0x61f0902c
y.create.l HWIO_GFX_SMMU_CB2_TTBR1_HIGH_GFX_ADDR A:0x61f0a02c
y.create.l HWIO_GFX_SMMU_CB3_TTBR1_HIGH_GFX_ADDR A:0x61f0b02c
y.create.l HWIO_GFX_SMMU_CB0_TCR_LPAE_GFX_ADDR A:0x61f08030
y.create.l HWIO_GFX_SMMU_CB1_TCR_LPAE_GFX_ADDR A:0x61f09030
y.create.l HWIO_GFX_SMMU_CB2_TCR_LPAE_GFX_ADDR A:0x61f0a030
y.create.l HWIO_GFX_SMMU_CB3_TCR_LPAE_GFX_ADDR A:0x61f0b030
y.create.l HWIO_GFX_SMMU_CB0_CONTEXTIDR_GFX_ADDR A:0x61f08034
y.create.l HWIO_GFX_SMMU_CB1_CONTEXTIDR_GFX_ADDR A:0x61f09034
y.create.l HWIO_GFX_SMMU_CB2_CONTEXTIDR_GFX_ADDR A:0x61f0a034
y.create.l HWIO_GFX_SMMU_CB3_CONTEXTIDR_GFX_ADDR A:0x61f0b034
y.create.l HWIO_GFX_SMMU_CB0_PRRR_MAIR0_GFX_ADDR A:0x61f08038
y.create.l HWIO_GFX_SMMU_CB1_PRRR_MAIR0_GFX_ADDR A:0x61f09038
y.create.l HWIO_GFX_SMMU_CB2_PRRR_MAIR0_GFX_ADDR A:0x61f0a038
y.create.l HWIO_GFX_SMMU_CB3_PRRR_MAIR0_GFX_ADDR A:0x61f0b038
y.create.l HWIO_GFX_SMMU_CB0_NMRR_MAIR1_GFX_ADDR A:0x61f0803c
y.create.l HWIO_GFX_SMMU_CB1_NMRR_MAIR1_GFX_ADDR A:0x61f0903c
y.create.l HWIO_GFX_SMMU_CB2_NMRR_MAIR1_GFX_ADDR A:0x61f0a03c
y.create.l HWIO_GFX_SMMU_CB3_NMRR_MAIR1_GFX_ADDR A:0x61f0b03c
y.create.l HWIO_GFX_SMMU_CB0_FSR_GFX_ADDR A:0x61f08058
y.create.l HWIO_GFX_SMMU_CB1_FSR_GFX_ADDR A:0x61f09058
y.create.l HWIO_GFX_SMMU_CB2_FSR_GFX_ADDR A:0x61f0a058
y.create.l HWIO_GFX_SMMU_CB3_FSR_GFX_ADDR A:0x61f0b058
y.create.l HWIO_GFX_SMMU_CB0_FSRRESTORE_GFX_ADDR A:0x61f0805c
y.create.l HWIO_GFX_SMMU_CB1_FSRRESTORE_GFX_ADDR A:0x61f0905c
y.create.l HWIO_GFX_SMMU_CB2_FSRRESTORE_GFX_ADDR A:0x61f0a05c
y.create.l HWIO_GFX_SMMU_CB3_FSRRESTORE_GFX_ADDR A:0x61f0b05c
y.create.l HWIO_GFX_SMMU_CB0_FAR_LOW_GFX_ADDR A:0x61f08060
y.create.l HWIO_GFX_SMMU_CB1_FAR_LOW_GFX_ADDR A:0x61f09060
y.create.l HWIO_GFX_SMMU_CB2_FAR_LOW_GFX_ADDR A:0x61f0a060
y.create.l HWIO_GFX_SMMU_CB3_FAR_LOW_GFX_ADDR A:0x61f0b060
y.create.l HWIO_GFX_SMMU_CB0_FAR_HIGH_GFX_ADDR A:0x61f08064
y.create.l HWIO_GFX_SMMU_CB1_FAR_HIGH_GFX_ADDR A:0x61f09064
y.create.l HWIO_GFX_SMMU_CB2_FAR_HIGH_GFX_ADDR A:0x61f0a064
y.create.l HWIO_GFX_SMMU_CB3_FAR_HIGH_GFX_ADDR A:0x61f0b064
y.create.l HWIO_GFX_SMMU_CB0_FSYNR0_GFX_ADDR A:0x61f08068
y.create.l HWIO_GFX_SMMU_CB1_FSYNR0_GFX_ADDR A:0x61f09068
y.create.l HWIO_GFX_SMMU_CB2_FSYNR0_GFX_ADDR A:0x61f0a068
y.create.l HWIO_GFX_SMMU_CB3_FSYNR0_GFX_ADDR A:0x61f0b068
y.create.l HWIO_GFX_SMMU_CB0_IPAFAR_LOW_GFX_ADDR A:0x61f08070
y.create.l HWIO_GFX_SMMU_CB1_IPAFAR_LOW_GFX_ADDR A:0x61f09070
y.create.l HWIO_GFX_SMMU_CB2_IPAFAR_LOW_GFX_ADDR A:0x61f0a070
y.create.l HWIO_GFX_SMMU_CB3_IPAFAR_LOW_GFX_ADDR A:0x61f0b070
y.create.l HWIO_GFX_SMMU_CB0_IPAFAR_HIGH_GFX_ADDR A:0x61f08074
y.create.l HWIO_GFX_SMMU_CB1_IPAFAR_HIGH_GFX_ADDR A:0x61f09074
y.create.l HWIO_GFX_SMMU_CB2_IPAFAR_HIGH_GFX_ADDR A:0x61f0a074
y.create.l HWIO_GFX_SMMU_CB3_IPAFAR_HIGH_GFX_ADDR A:0x61f0b074
y.create.l HWIO_GFX_SMMU_CB0_TLBIVA_LOW_GFX_ADDR A:0x61f08600
y.create.l HWIO_GFX_SMMU_CB1_TLBIVA_LOW_GFX_ADDR A:0x61f09600
y.create.l HWIO_GFX_SMMU_CB2_TLBIVA_LOW_GFX_ADDR A:0x61f0a600
y.create.l HWIO_GFX_SMMU_CB3_TLBIVA_LOW_GFX_ADDR A:0x61f0b600
y.create.l HWIO_GFX_SMMU_CB0_TLBIVA_HIGH_GFX_ADDR A:0x61f08604
y.create.l HWIO_GFX_SMMU_CB1_TLBIVA_HIGH_GFX_ADDR A:0x61f09604
y.create.l HWIO_GFX_SMMU_CB2_TLBIVA_HIGH_GFX_ADDR A:0x61f0a604
y.create.l HWIO_GFX_SMMU_CB3_TLBIVA_HIGH_GFX_ADDR A:0x61f0b604
y.create.l HWIO_GFX_SMMU_CB0_TLBIVAA_LOW_GFX_ADDR A:0x61f08608
y.create.l HWIO_GFX_SMMU_CB1_TLBIVAA_LOW_GFX_ADDR A:0x61f09608
y.create.l HWIO_GFX_SMMU_CB2_TLBIVAA_LOW_GFX_ADDR A:0x61f0a608
y.create.l HWIO_GFX_SMMU_CB3_TLBIVAA_LOW_GFX_ADDR A:0x61f0b608
y.create.l HWIO_GFX_SMMU_CB0_TLBIVAA_HIGH_GFX_ADDR A:0x61f0860c
y.create.l HWIO_GFX_SMMU_CB1_TLBIVAA_HIGH_GFX_ADDR A:0x61f0960c
y.create.l HWIO_GFX_SMMU_CB2_TLBIVAA_HIGH_GFX_ADDR A:0x61f0a60c
y.create.l HWIO_GFX_SMMU_CB3_TLBIVAA_HIGH_GFX_ADDR A:0x61f0b60c
y.create.l HWIO_GFX_SMMU_CB0_TLBIASID_GFX_ADDR A:0x61f08610
y.create.l HWIO_GFX_SMMU_CB1_TLBIASID_GFX_ADDR A:0x61f09610
y.create.l HWIO_GFX_SMMU_CB2_TLBIASID_GFX_ADDR A:0x61f0a610
y.create.l HWIO_GFX_SMMU_CB3_TLBIASID_GFX_ADDR A:0x61f0b610
y.create.l HWIO_GFX_SMMU_CB0_TLBIALL_GFX_ADDR A:0x61f08618
y.create.l HWIO_GFX_SMMU_CB1_TLBIALL_GFX_ADDR A:0x61f09618
y.create.l HWIO_GFX_SMMU_CB2_TLBIALL_GFX_ADDR A:0x61f0a618
y.create.l HWIO_GFX_SMMU_CB3_TLBIALL_GFX_ADDR A:0x61f0b618
y.create.l HWIO_GFX_SMMU_CB0_TLBIVAL_LOW_GFX_ADDR A:0x61f08620
y.create.l HWIO_GFX_SMMU_CB1_TLBIVAL_LOW_GFX_ADDR A:0x61f09620
y.create.l HWIO_GFX_SMMU_CB2_TLBIVAL_LOW_GFX_ADDR A:0x61f0a620
y.create.l HWIO_GFX_SMMU_CB3_TLBIVAL_LOW_GFX_ADDR A:0x61f0b620
y.create.l HWIO_GFX_SMMU_CB0_TLBIVAL_HIGH_GFX_ADDR A:0x61f08624
y.create.l HWIO_GFX_SMMU_CB1_TLBIVAL_HIGH_GFX_ADDR A:0x61f09624
y.create.l HWIO_GFX_SMMU_CB2_TLBIVAL_HIGH_GFX_ADDR A:0x61f0a624
y.create.l HWIO_GFX_SMMU_CB3_TLBIVAL_HIGH_GFX_ADDR A:0x61f0b624
y.create.l HWIO_GFX_SMMU_CB0_TLBIVAAL_LOW_GFX_ADDR A:0x61f08628
y.create.l HWIO_GFX_SMMU_CB1_TLBIVAAL_LOW_GFX_ADDR A:0x61f09628
y.create.l HWIO_GFX_SMMU_CB2_TLBIVAAL_LOW_GFX_ADDR A:0x61f0a628
y.create.l HWIO_GFX_SMMU_CB3_TLBIVAAL_LOW_GFX_ADDR A:0x61f0b628
y.create.l HWIO_GFX_SMMU_CB0_TLBIVAAL_HIGH_GFX_ADDR A:0x61f0862c
y.create.l HWIO_GFX_SMMU_CB1_TLBIVAAL_HIGH_GFX_ADDR A:0x61f0962c
y.create.l HWIO_GFX_SMMU_CB2_TLBIVAAL_HIGH_GFX_ADDR A:0x61f0a62c
y.create.l HWIO_GFX_SMMU_CB3_TLBIVAAL_HIGH_GFX_ADDR A:0x61f0b62c
y.create.l HWIO_GFX_SMMU_CB0_TLBIIPAS2_LOW_GFX_ADDR A:0x61f08630
y.create.l HWIO_GFX_SMMU_CB1_TLBIIPAS2_LOW_GFX_ADDR A:0x61f09630
y.create.l HWIO_GFX_SMMU_CB2_TLBIIPAS2_LOW_GFX_ADDR A:0x61f0a630
y.create.l HWIO_GFX_SMMU_CB3_TLBIIPAS2_LOW_GFX_ADDR A:0x61f0b630
y.create.l HWIO_GFX_SMMU_CB0_TLBIIPAS2_HIGH_GFX_ADDR A:0x61f08634
y.create.l HWIO_GFX_SMMU_CB1_TLBIIPAS2_HIGH_GFX_ADDR A:0x61f09634
y.create.l HWIO_GFX_SMMU_CB2_TLBIIPAS2_HIGH_GFX_ADDR A:0x61f0a634
y.create.l HWIO_GFX_SMMU_CB3_TLBIIPAS2_HIGH_GFX_ADDR A:0x61f0b634
y.create.l HWIO_GFX_SMMU_CB0_TLBIIPAS2L_LOW_GFX_ADDR A:0x61f08638
y.create.l HWIO_GFX_SMMU_CB1_TLBIIPAS2L_LOW_GFX_ADDR A:0x61f09638
y.create.l HWIO_GFX_SMMU_CB2_TLBIIPAS2L_LOW_GFX_ADDR A:0x61f0a638
y.create.l HWIO_GFX_SMMU_CB3_TLBIIPAS2L_LOW_GFX_ADDR A:0x61f0b638
y.create.l HWIO_GFX_SMMU_CB0_TLBIIPAS2L_HIGH_GFX_ADDR A:0x61f0863c
y.create.l HWIO_GFX_SMMU_CB1_TLBIIPAS2L_HIGH_GFX_ADDR A:0x61f0963c
y.create.l HWIO_GFX_SMMU_CB2_TLBIIPAS2L_HIGH_GFX_ADDR A:0x61f0a63c
y.create.l HWIO_GFX_SMMU_CB3_TLBIIPAS2L_HIGH_GFX_ADDR A:0x61f0b63c
y.create.l HWIO_GFX_SMMU_CB0_TLBSYNC_GFX_ADDR A:0x61f087f0
y.create.l HWIO_GFX_SMMU_CB1_TLBSYNC_GFX_ADDR A:0x61f097f0
y.create.l HWIO_GFX_SMMU_CB2_TLBSYNC_GFX_ADDR A:0x61f0a7f0
y.create.l HWIO_GFX_SMMU_CB3_TLBSYNC_GFX_ADDR A:0x61f0b7f0
y.create.l HWIO_GFX_SMMU_CB0_TLBSTATUS_GFX_ADDR A:0x61f087f4
y.create.l HWIO_GFX_SMMU_CB1_TLBSTATUS_GFX_ADDR A:0x61f097f4
y.create.l HWIO_GFX_SMMU_CB2_TLBSTATUS_GFX_ADDR A:0x61f0a7f4
y.create.l HWIO_GFX_SMMU_CB3_TLBSTATUS_GFX_ADDR A:0x61f0b7f4
y.create.l HWIO_GFX_SMMU_CB0_PMEVCNTR0_GFX_ADDR A:0x61f08e00
y.create.l HWIO_GFX_SMMU_CB1_PMEVCNTR0_GFX_ADDR A:0x61f09e00
y.create.l HWIO_GFX_SMMU_CB2_PMEVCNTR0_GFX_ADDR A:0x61f0ae00
y.create.l HWIO_GFX_SMMU_CB3_PMEVCNTR0_GFX_ADDR A:0x61f0be00
y.create.l HWIO_GFX_SMMU_CB0_PMEVCNTR1_GFX_ADDR A:0x61f08e04
y.create.l HWIO_GFX_SMMU_CB1_PMEVCNTR1_GFX_ADDR A:0x61f09e04
y.create.l HWIO_GFX_SMMU_CB2_PMEVCNTR1_GFX_ADDR A:0x61f0ae04
y.create.l HWIO_GFX_SMMU_CB3_PMEVCNTR1_GFX_ADDR A:0x61f0be04
y.create.l HWIO_GFX_SMMU_CB0_PMEVCNTR2_GFX_ADDR A:0x61f08e08
y.create.l HWIO_GFX_SMMU_CB1_PMEVCNTR2_GFX_ADDR A:0x61f09e08
y.create.l HWIO_GFX_SMMU_CB2_PMEVCNTR2_GFX_ADDR A:0x61f0ae08
y.create.l HWIO_GFX_SMMU_CB3_PMEVCNTR2_GFX_ADDR A:0x61f0be08
y.create.l HWIO_GFX_SMMU_CB0_PMEVCNTR3_GFX_ADDR A:0x61f08e0c
y.create.l HWIO_GFX_SMMU_CB1_PMEVCNTR3_GFX_ADDR A:0x61f09e0c
y.create.l HWIO_GFX_SMMU_CB2_PMEVCNTR3_GFX_ADDR A:0x61f0ae0c
y.create.l HWIO_GFX_SMMU_CB3_PMEVCNTR3_GFX_ADDR A:0x61f0be0c
y.create.l HWIO_GFX_SMMU_CB0_PMEVTYPER0_GFX_ADDR A:0x61f08e80
y.create.l HWIO_GFX_SMMU_CB1_PMEVTYPER0_GFX_ADDR A:0x61f09e80
y.create.l HWIO_GFX_SMMU_CB2_PMEVTYPER0_GFX_ADDR A:0x61f0ae80
y.create.l HWIO_GFX_SMMU_CB3_PMEVTYPER0_GFX_ADDR A:0x61f0be80
y.create.l HWIO_GFX_SMMU_CB0_PMEVTYPER1_GFX_ADDR A:0x61f08e84
y.create.l HWIO_GFX_SMMU_CB1_PMEVTYPER1_GFX_ADDR A:0x61f09e84
y.create.l HWIO_GFX_SMMU_CB2_PMEVTYPER1_GFX_ADDR A:0x61f0ae84
y.create.l HWIO_GFX_SMMU_CB3_PMEVTYPER1_GFX_ADDR A:0x61f0be84
y.create.l HWIO_GFX_SMMU_CB0_PMEVTYPER2_GFX_ADDR A:0x61f08e88
y.create.l HWIO_GFX_SMMU_CB1_PMEVTYPER2_GFX_ADDR A:0x61f09e88
y.create.l HWIO_GFX_SMMU_CB2_PMEVTYPER2_GFX_ADDR A:0x61f0ae88
y.create.l HWIO_GFX_SMMU_CB3_PMEVTYPER2_GFX_ADDR A:0x61f0be88
y.create.l HWIO_GFX_SMMU_CB0_PMEVTYPER3_GFX_ADDR A:0x61f08e8c
y.create.l HWIO_GFX_SMMU_CB1_PMEVTYPER3_GFX_ADDR A:0x61f09e8c
y.create.l HWIO_GFX_SMMU_CB2_PMEVTYPER3_GFX_ADDR A:0x61f0ae8c
y.create.l HWIO_GFX_SMMU_CB3_PMEVTYPER3_GFX_ADDR A:0x61f0be8c
y.create.l HWIO_GFX_SMMU_CB0_PMCFGR_GFX_ADDR A:0x61f08f00
y.create.l HWIO_GFX_SMMU_CB1_PMCFGR_GFX_ADDR A:0x61f09f00
y.create.l HWIO_GFX_SMMU_CB2_PMCFGR_GFX_ADDR A:0x61f0af00
y.create.l HWIO_GFX_SMMU_CB3_PMCFGR_GFX_ADDR A:0x61f0bf00
y.create.l HWIO_GFX_SMMU_CB0_PMCR_GFX_ADDR A:0x61f08f04
y.create.l HWIO_GFX_SMMU_CB1_PMCR_GFX_ADDR A:0x61f09f04
y.create.l HWIO_GFX_SMMU_CB2_PMCR_GFX_ADDR A:0x61f0af04
y.create.l HWIO_GFX_SMMU_CB3_PMCR_GFX_ADDR A:0x61f0bf04
y.create.l HWIO_GFX_SMMU_CB0_PMCEID_GFX_ADDR A:0x61f08f20
y.create.l HWIO_GFX_SMMU_CB1_PMCEID_GFX_ADDR A:0x61f09f20
y.create.l HWIO_GFX_SMMU_CB2_PMCEID_GFX_ADDR A:0x61f0af20
y.create.l HWIO_GFX_SMMU_CB3_PMCEID_GFX_ADDR A:0x61f0bf20
y.create.l HWIO_GFX_SMMU_CB0_PMCNTENSE_GFX_ADDR A:0x61f08f40
y.create.l HWIO_GFX_SMMU_CB1_PMCNTENSE_GFX_ADDR A:0x61f09f40
y.create.l HWIO_GFX_SMMU_CB2_PMCNTENSE_GFX_ADDR A:0x61f0af40
y.create.l HWIO_GFX_SMMU_CB3_PMCNTENSE_GFX_ADDR A:0x61f0bf40
y.create.l HWIO_GFX_SMMU_CB0_PMCNTENCLR_GFX_ADDR A:0x61f08f44
y.create.l HWIO_GFX_SMMU_CB1_PMCNTENCLR_GFX_ADDR A:0x61f09f44
y.create.l HWIO_GFX_SMMU_CB2_PMCNTENCLR_GFX_ADDR A:0x61f0af44
y.create.l HWIO_GFX_SMMU_CB3_PMCNTENCLR_GFX_ADDR A:0x61f0bf44
y.create.l HWIO_GFX_SMMU_CB0_PMCNTENSET_GFX_ADDR A:0x61f08f48
y.create.l HWIO_GFX_SMMU_CB1_PMCNTENSET_GFX_ADDR A:0x61f09f48
y.create.l HWIO_GFX_SMMU_CB2_PMCNTENSET_GFX_ADDR A:0x61f0af48
y.create.l HWIO_GFX_SMMU_CB3_PMCNTENSET_GFX_ADDR A:0x61f0bf48
y.create.l HWIO_GFX_SMMU_CB0_PMINTENCLR_GFX_ADDR A:0x61f08f4c
y.create.l HWIO_GFX_SMMU_CB1_PMINTENCLR_GFX_ADDR A:0x61f09f4c
y.create.l HWIO_GFX_SMMU_CB2_PMINTENCLR_GFX_ADDR A:0x61f0af4c
y.create.l HWIO_GFX_SMMU_CB3_PMINTENCLR_GFX_ADDR A:0x61f0bf4c
y.create.l HWIO_GFX_SMMU_CB0_PMOVSCLR_GFX_ADDR A:0x61f08f50
y.create.l HWIO_GFX_SMMU_CB1_PMOVSCLR_GFX_ADDR A:0x61f09f50
y.create.l HWIO_GFX_SMMU_CB2_PMOVSCLR_GFX_ADDR A:0x61f0af50
y.create.l HWIO_GFX_SMMU_CB3_PMOVSCLR_GFX_ADDR A:0x61f0bf50
y.create.l HWIO_GFX_SMMU_CB0_PMOVSSET_GFX_ADDR A:0x61f08f58
y.create.l HWIO_GFX_SMMU_CB1_PMOVSSET_GFX_ADDR A:0x61f09f58
y.create.l HWIO_GFX_SMMU_CB2_PMOVSSET_GFX_ADDR A:0x61f0af58
y.create.l HWIO_GFX_SMMU_CB3_PMOVSSET_GFX_ADDR A:0x61f0bf58
y.create.l HWIO_GFX_SMMU_CB0_PMAUTHSTATUS_GFX_ADDR A:0x61f08fb8
y.create.l HWIO_GFX_SMMU_CB1_PMAUTHSTATUS_GFX_ADDR A:0x61f09fb8
y.create.l HWIO_GFX_SMMU_CB2_PMAUTHSTATUS_GFX_ADDR A:0x61f0afb8
y.create.l HWIO_GFX_SMMU_CB3_PMAUTHSTATUS_GFX_ADDR A:0x61f0bfb8
y.create.l HWIO_GFX_SMMU_CR0_GFX_ADDR A:0x61f00000
y.create.l HWIO_GFX_SMMU_ACR_GFX_ADDR A:0x61f00010
y.create.l HWIO_GFX_SMMU_IDR0_GFX_ADDR A:0x61f00020
y.create.l HWIO_GFX_SMMU_IDR1_GFX_ADDR A:0x61f00024
y.create.l HWIO_GFX_SMMU_IDR2_GFX_ADDR A:0x61f00028
y.create.l HWIO_GFX_SMMU_IDR7_GFX_ADDR A:0x61f0003c
y.create.l HWIO_GFX_SMMU_GFAR_LOW_GFX_ADDR A:0x61f00040
y.create.l HWIO_GFX_SMMU_GFAR_HIGH_GFX_ADDR A:0x61f00044
y.create.l HWIO_GFX_SMMU_GFSR_GFX_ADDR A:0x61f00048
y.create.l HWIO_GFX_SMMU_GFSRRESTORE_GFX_ADDR A:0x61f0004c
y.create.l HWIO_GFX_SMMU_GFSYNR0_GFX_ADDR A:0x61f00050
y.create.l HWIO_GFX_SMMU_GFSYNR1_GFX_ADDR A:0x61f00054
y.create.l HWIO_GFX_SMMU_TLBIVMID_2_GFX_ADDR A:0x61f00064
y.create.l HWIO_GFX_SMMU_TLBIALLNSNH_2_GFX_ADDR A:0x61f00068
y.create.l HWIO_GFX_SMMU_TLBIALLH_GFX_ADDR A:0x61f0006c
y.create.l HWIO_GFX_SMMU_TLBGSYNC_GFX_ADDR A:0x61f00070
y.create.l HWIO_GFX_SMMU_TLBGSTATUS_GFX_ADDR A:0x61f00074
y.create.l HWIO_GFX_SMMU_TLBIVAH_LOW_GFX_ADDR A:0x61f00078
y.create.l HWIO_GFX_SMMU_TLBIVALH64_LOW_GFX_ADDR A:0x61f000b0
y.create.l HWIO_GFX_SMMU_TLBIVALH64_HIGH_GFX_ADDR A:0x61f000b4
y.create.l HWIO_GFX_SMMU_TLBIVMIDS1_GFX_ADDR A:0x61f000b8
y.create.l HWIO_GFX_SMMU_TLBIVAH64_LOW_GFX_ADDR A:0x61f000c0
y.create.l HWIO_GFX_SMMU_TLBIVAH64_HIGH_GFX_ADDR A:0x61f000c4
y.create.l HWIO_GFX_SMMU_SMR0_2_GFX_ADDR A:0x61f00800
y.create.l HWIO_GFX_SMMU_SMR1_2_GFX_ADDR A:0x61f00804
y.create.l HWIO_GFX_SMMU_SMR2_2_GFX_ADDR A:0x61f00808
y.create.l HWIO_GFX_SMMU_SMR3_2_GFX_ADDR A:0x61f0080c
y.create.l HWIO_GFX_SMMU_S2CR0_2_GFX_ADDR A:0x61f00c00
y.create.l HWIO_GFX_SMMU_S2CR1_2_GFX_ADDR A:0x61f00c04
y.create.l HWIO_GFX_SMMU_S2CR2_2_GFX_ADDR A:0x61f00c08
y.create.l HWIO_GFX_SMMU_S2CR3_2_GFX_ADDR A:0x61f00c0c
y.create.l HWIO_GFX_SMMU_PIDR0_2_GFX_ADDR A:0x61f00fe0
y.create.l HWIO_GFX_SMMU_PIDR1_2_GFX_ADDR A:0x61f00fe4
y.create.l HWIO_GFX_SMMU_PIDR2_2_GFX_ADDR A:0x61f00fe8
y.create.l HWIO_GFX_SMMU_PIDR3_2_GFX_ADDR A:0x61f00fec
y.create.l HWIO_GFX_SMMU_PIDR4_2_GFX_ADDR A:0x61f00fd0
y.create.l HWIO_GFX_SMMU_PIDR5_2_GFX_ADDR A:0x61f00fd4
y.create.l HWIO_GFX_SMMU_PIDR6_2_GFX_ADDR A:0x61f00fd8
y.create.l HWIO_GFX_SMMU_PIDR7_2_GFX_ADDR A:0x61f00fdc
y.create.l HWIO_GFX_SMMU_CIDR0_2_GFX_ADDR A:0x61f00ff0
y.create.l HWIO_GFX_SMMU_CIDR1_2_GFX_ADDR A:0x61f00ff4
y.create.l HWIO_GFX_SMMU_CIDR2_2_GFX_ADDR A:0x61f00ff8
y.create.l HWIO_GFX_SMMU_CIDR3_2_GFX_ADDR A:0x61f00ffc
y.create.l HWIO_GFX_SMMU_CBAR0_2_GFX_ADDR A:0x61f01000
y.create.l HWIO_GFX_SMMU_CBFRSYNRA0_2_GFX_ADDR A:0x61f01400
y.create.l HWIO_GFX_SMMU_CBA2R0_2_GFX_ADDR A:0x61f01800
y.create.l HWIO_GFX_SMMU_CBAR1_2_GFX_ADDR A:0x61f01004
y.create.l HWIO_GFX_SMMU_CBFRSYNRA1_2_GFX_ADDR A:0x61f01404
y.create.l HWIO_GFX_SMMU_CBA2R1_2_GFX_ADDR A:0x61f01804
y.create.l HWIO_GFX_SMMU_CBAR2_2_GFX_ADDR A:0x61f01008
y.create.l HWIO_GFX_SMMU_CBFRSYNRA2_2_GFX_ADDR A:0x61f01408
y.create.l HWIO_GFX_SMMU_CBA2R2_2_GFX_ADDR A:0x61f01808
y.create.l HWIO_GFX_SMMU_CBAR3_2_GFX_ADDR A:0x61f0100c
y.create.l HWIO_GFX_SMMU_CBFRSYNRA3_2_GFX_ADDR A:0x61f0140c
y.create.l HWIO_GFX_SMMU_CBA2R3_2_GFX_ADDR A:0x61f0180c
y.create.l HWIO_GFX_PMEVCNTR0_2_GFX_ADDR A:0x61f03000
y.create.l HWIO_GFX_PMEVCNTR1_2_GFX_ADDR A:0x61f03004
y.create.l HWIO_GFX_PMEVCNTR2_2_GFX_ADDR A:0x61f03008
y.create.l HWIO_GFX_PMEVCNTR3_2_GFX_ADDR A:0x61f0300c
y.create.l HWIO_GFX_PMEVTYPER0_2_GFX_ADDR A:0x61f03400
y.create.l HWIO_GFX_PMEVTYPER1_2_GFX_ADDR A:0x61f03404
y.create.l HWIO_GFX_PMEVTYPER2_2_GFX_ADDR A:0x61f03408
y.create.l HWIO_GFX_PMEVTYPER3_2_GFX_ADDR A:0x61f0340c
y.create.l HWIO_GFX_PMCGCR_2_GFX_ADDR A:0x61f03800
y.create.l HWIO_GFX_PMCGSMR_2_GFX_ADDR A:0x61f03a00
y.create.l HWIO_GFX_PMCNTENSET_2_GFX_ADDR A:0x61f03c00
y.create.l HWIO_GFX_PMCNTENCLR_2_GFX_ADDR A:0x61f03c20
y.create.l HWIO_GFX_PMINTENSET_2_GFX_ADDR A:0x61f03c40
y.create.l HWIO_GFX_PMINTENCLR_2_GFX_ADDR A:0x61f03c60
y.create.l HWIO_GFX_PMOVSCLR_2_GFX_ADDR A:0x61f03c80
y.create.l HWIO_GFX_PMOVSSET_2_GFX_ADDR A:0x61f03cc0
y.create.l HWIO_GFX_PMCFGR_2_GFX_ADDR A:0x61f03e00
y.create.l HWIO_GFX_PMCR_2_GFX_ADDR A:0x61f03e04
y.create.l HWIO_GFX_PMCEID0_2_GFX_ADDR A:0x61f03e20
y.create.l HWIO_GFX_PMAUTHSTATUS_2_GFX_ADDR A:0x61f03fb8
y.create.l HWIO_GFX_PMDEVTYPE_2_GFX_ADDR A:0x61f03fcc
y.create.l HWIO_GFX_SMMU_CB0_SCTLR_2_GFX_ADDR A:0x61f08000
y.create.l HWIO_GFX_SMMU_CB1_SCTLR_2_GFX_ADDR A:0x61f09000
y.create.l HWIO_GFX_SMMU_CB2_SCTLR_2_GFX_ADDR A:0x61f0a000
y.create.l HWIO_GFX_SMMU_CB3_SCTLR_2_GFX_ADDR A:0x61f0b000
y.create.l HWIO_GFX_SMMU_CB0_ACTLR_2_GFX_ADDR A:0x61f08004
y.create.l HWIO_GFX_SMMU_CB1_ACTLR_2_GFX_ADDR A:0x61f09004
y.create.l HWIO_GFX_SMMU_CB2_ACTLR_2_GFX_ADDR A:0x61f0a004
y.create.l HWIO_GFX_SMMU_CB3_ACTLR_2_GFX_ADDR A:0x61f0b004
y.create.l HWIO_GFX_SMMU_CB0_RESUME_2_GFX_ADDR A:0x61f08008
y.create.l HWIO_GFX_SMMU_CB1_RESUME_2_GFX_ADDR A:0x61f09008
y.create.l HWIO_GFX_SMMU_CB2_RESUME_2_GFX_ADDR A:0x61f0a008
y.create.l HWIO_GFX_SMMU_CB3_RESUME_2_GFX_ADDR A:0x61f0b008
y.create.l HWIO_GFX_SMMU_CB0_TCR2_2_GFX_ADDR A:0x61f08010
y.create.l HWIO_GFX_SMMU_CB1_TCR2_2_GFX_ADDR A:0x61f09010
y.create.l HWIO_GFX_SMMU_CB2_TCR2_2_GFX_ADDR A:0x61f0a010
y.create.l HWIO_GFX_SMMU_CB3_TCR2_2_GFX_ADDR A:0x61f0b010
y.create.l HWIO_GFX_SMMU_CB0_TTBR0_LOW_2_GFX_ADDR A:0x61f08020
y.create.l HWIO_GFX_SMMU_CB1_TTBR0_LOW_2_GFX_ADDR A:0x61f09020
y.create.l HWIO_GFX_SMMU_CB2_TTBR0_LOW_2_GFX_ADDR A:0x61f0a020
y.create.l HWIO_GFX_SMMU_CB3_TTBR0_LOW_2_GFX_ADDR A:0x61f0b020
y.create.l HWIO_GFX_SMMU_CB0_TTBR0_HIGH_2_GFX_ADDR A:0x61f08024
y.create.l HWIO_GFX_SMMU_CB1_TTBR0_HIGH_2_GFX_ADDR A:0x61f09024
y.create.l HWIO_GFX_SMMU_CB2_TTBR0_HIGH_2_GFX_ADDR A:0x61f0a024
y.create.l HWIO_GFX_SMMU_CB3_TTBR0_HIGH_2_GFX_ADDR A:0x61f0b024
y.create.l HWIO_GFX_SMMU_CB0_TTBR1_LOW_2_GFX_ADDR A:0x61f08028
y.create.l HWIO_GFX_SMMU_CB1_TTBR1_LOW_2_GFX_ADDR A:0x61f09028
y.create.l HWIO_GFX_SMMU_CB2_TTBR1_LOW_2_GFX_ADDR A:0x61f0a028
y.create.l HWIO_GFX_SMMU_CB3_TTBR1_LOW_2_GFX_ADDR A:0x61f0b028
y.create.l HWIO_GFX_SMMU_CB0_TTBR1_HIGH_2_GFX_ADDR A:0x61f0802c
y.create.l HWIO_GFX_SMMU_CB1_TTBR1_HIGH_2_GFX_ADDR A:0x61f0902c
y.create.l HWIO_GFX_SMMU_CB2_TTBR1_HIGH_2_GFX_ADDR A:0x61f0a02c
y.create.l HWIO_GFX_SMMU_CB3_TTBR1_HIGH_2_GFX_ADDR A:0x61f0b02c
y.create.l HWIO_GFX_SMMU_CB0_TCR_LPAE_2_GFX_ADDR A:0x61f08030
y.create.l HWIO_GFX_SMMU_CB1_TCR_LPAE_2_GFX_ADDR A:0x61f09030
y.create.l HWIO_GFX_SMMU_CB2_TCR_LPAE_2_GFX_ADDR A:0x61f0a030
y.create.l HWIO_GFX_SMMU_CB3_TCR_LPAE_2_GFX_ADDR A:0x61f0b030
y.create.l HWIO_GFX_SMMU_CB0_CONTEXTIDR_2_GFX_ADDR A:0x61f08034
y.create.l HWIO_GFX_SMMU_CB1_CONTEXTIDR_2_GFX_ADDR A:0x61f09034
y.create.l HWIO_GFX_SMMU_CB2_CONTEXTIDR_2_GFX_ADDR A:0x61f0a034
y.create.l HWIO_GFX_SMMU_CB3_CONTEXTIDR_2_GFX_ADDR A:0x61f0b034
y.create.l HWIO_GFX_SMMU_CB0_PRRR_MAIR0_2_GFX_ADDR A:0x61f08038
y.create.l HWIO_GFX_SMMU_CB1_PRRR_MAIR0_2_GFX_ADDR A:0x61f09038
y.create.l HWIO_GFX_SMMU_CB2_PRRR_MAIR0_2_GFX_ADDR A:0x61f0a038
y.create.l HWIO_GFX_SMMU_CB3_PRRR_MAIR0_2_GFX_ADDR A:0x61f0b038
y.create.l HWIO_GFX_SMMU_CB0_NMRR_MAIR1_2_GFX_ADDR A:0x61f0803c
y.create.l HWIO_GFX_SMMU_CB1_NMRR_MAIR1_2_GFX_ADDR A:0x61f0903c
y.create.l HWIO_GFX_SMMU_CB2_NMRR_MAIR1_2_GFX_ADDR A:0x61f0a03c
y.create.l HWIO_GFX_SMMU_CB3_NMRR_MAIR1_2_GFX_ADDR A:0x61f0b03c
y.create.l HWIO_GFX_SMMU_CB0_FSR_2_GFX_ADDR A:0x61f08058
y.create.l HWIO_GFX_SMMU_CB1_FSR_2_GFX_ADDR A:0x61f09058
y.create.l HWIO_GFX_SMMU_CB2_FSR_2_GFX_ADDR A:0x61f0a058
y.create.l HWIO_GFX_SMMU_CB3_FSR_2_GFX_ADDR A:0x61f0b058
y.create.l HWIO_GFX_SMMU_CB0_FSRRESTORE_2_GFX_ADDR A:0x61f0805c
y.create.l HWIO_GFX_SMMU_CB1_FSRRESTORE_2_GFX_ADDR A:0x61f0905c
y.create.l HWIO_GFX_SMMU_CB2_FSRRESTORE_2_GFX_ADDR A:0x61f0a05c
y.create.l HWIO_GFX_SMMU_CB3_FSRRESTORE_2_GFX_ADDR A:0x61f0b05c
y.create.l HWIO_GFX_SMMU_CB0_FAR_LOW_2_GFX_ADDR A:0x61f08060
y.create.l HWIO_GFX_SMMU_CB1_FAR_LOW_2_GFX_ADDR A:0x61f09060
y.create.l HWIO_GFX_SMMU_CB2_FAR_LOW_2_GFX_ADDR A:0x61f0a060
y.create.l HWIO_GFX_SMMU_CB3_FAR_LOW_2_GFX_ADDR A:0x61f0b060
y.create.l HWIO_GFX_SMMU_CB0_FAR_HIGH_2_GFX_ADDR A:0x61f08064
y.create.l HWIO_GFX_SMMU_CB1_FAR_HIGH_2_GFX_ADDR A:0x61f09064
y.create.l HWIO_GFX_SMMU_CB2_FAR_HIGH_2_GFX_ADDR A:0x61f0a064
y.create.l HWIO_GFX_SMMU_CB3_FAR_HIGH_2_GFX_ADDR A:0x61f0b064
y.create.l HWIO_GFX_SMMU_CB0_FSYNR0_2_GFX_ADDR A:0x61f08068
y.create.l HWIO_GFX_SMMU_CB1_FSYNR0_2_GFX_ADDR A:0x61f09068
y.create.l HWIO_GFX_SMMU_CB2_FSYNR0_2_GFX_ADDR A:0x61f0a068
y.create.l HWIO_GFX_SMMU_CB3_FSYNR0_2_GFX_ADDR A:0x61f0b068
y.create.l HWIO_GFX_SMMU_CB0_IPAFAR_LOW_2_GFX_ADDR A:0x61f08070
y.create.l HWIO_GFX_SMMU_CB1_IPAFAR_LOW_2_GFX_ADDR A:0x61f09070
y.create.l HWIO_GFX_SMMU_CB2_IPAFAR_LOW_2_GFX_ADDR A:0x61f0a070
y.create.l HWIO_GFX_SMMU_CB3_IPAFAR_LOW_2_GFX_ADDR A:0x61f0b070
y.create.l HWIO_GFX_SMMU_CB0_IPAFAR_HIGH_2_GFX_ADDR A:0x61f08074
y.create.l HWIO_GFX_SMMU_CB1_IPAFAR_HIGH_2_GFX_ADDR A:0x61f09074
y.create.l HWIO_GFX_SMMU_CB2_IPAFAR_HIGH_2_GFX_ADDR A:0x61f0a074
y.create.l HWIO_GFX_SMMU_CB3_IPAFAR_HIGH_2_GFX_ADDR A:0x61f0b074
y.create.l HWIO_GFX_SMMU_CB0_TLBIVA_LOW_2_GFX_ADDR A:0x61f08600
y.create.l HWIO_GFX_SMMU_CB1_TLBIVA_LOW_2_GFX_ADDR A:0x61f09600
y.create.l HWIO_GFX_SMMU_CB2_TLBIVA_LOW_2_GFX_ADDR A:0x61f0a600
y.create.l HWIO_GFX_SMMU_CB3_TLBIVA_LOW_2_GFX_ADDR A:0x61f0b600
y.create.l HWIO_GFX_SMMU_CB0_TLBIVA_HIGH_2_GFX_ADDR A:0x61f08604
y.create.l HWIO_GFX_SMMU_CB1_TLBIVA_HIGH_2_GFX_ADDR A:0x61f09604
y.create.l HWIO_GFX_SMMU_CB2_TLBIVA_HIGH_2_GFX_ADDR A:0x61f0a604
y.create.l HWIO_GFX_SMMU_CB3_TLBIVA_HIGH_2_GFX_ADDR A:0x61f0b604
y.create.l HWIO_GFX_SMMU_CB0_TLBIVAA_LOW_2_GFX_ADDR A:0x61f08608
y.create.l HWIO_GFX_SMMU_CB1_TLBIVAA_LOW_2_GFX_ADDR A:0x61f09608
y.create.l HWIO_GFX_SMMU_CB2_TLBIVAA_LOW_2_GFX_ADDR A:0x61f0a608
y.create.l HWIO_GFX_SMMU_CB3_TLBIVAA_LOW_2_GFX_ADDR A:0x61f0b608
y.create.l HWIO_GFX_SMMU_CB0_TLBIVAA_HIGH_2_GFX_ADDR A:0x61f0860c
y.create.l HWIO_GFX_SMMU_CB1_TLBIVAA_HIGH_2_GFX_ADDR A:0x61f0960c
y.create.l HWIO_GFX_SMMU_CB2_TLBIVAA_HIGH_2_GFX_ADDR A:0x61f0a60c
y.create.l HWIO_GFX_SMMU_CB3_TLBIVAA_HIGH_2_GFX_ADDR A:0x61f0b60c
y.create.l HWIO_GFX_SMMU_CB0_TLBIASID_2_GFX_ADDR A:0x61f08610
y.create.l HWIO_GFX_SMMU_CB1_TLBIASID_2_GFX_ADDR A:0x61f09610
y.create.l HWIO_GFX_SMMU_CB2_TLBIASID_2_GFX_ADDR A:0x61f0a610
y.create.l HWIO_GFX_SMMU_CB3_TLBIASID_2_GFX_ADDR A:0x61f0b610
y.create.l HWIO_GFX_SMMU_CB0_TLBIALL_2_GFX_ADDR A:0x61f08618
y.create.l HWIO_GFX_SMMU_CB1_TLBIALL_2_GFX_ADDR A:0x61f09618
y.create.l HWIO_GFX_SMMU_CB2_TLBIALL_2_GFX_ADDR A:0x61f0a618
y.create.l HWIO_GFX_SMMU_CB3_TLBIALL_2_GFX_ADDR A:0x61f0b618
y.create.l HWIO_GFX_SMMU_CB0_TLBIVAL_LOW_2_GFX_ADDR A:0x61f08620
y.create.l HWIO_GFX_SMMU_CB1_TLBIVAL_LOW_2_GFX_ADDR A:0x61f09620
y.create.l HWIO_GFX_SMMU_CB2_TLBIVAL_LOW_2_GFX_ADDR A:0x61f0a620
y.create.l HWIO_GFX_SMMU_CB3_TLBIVAL_LOW_2_GFX_ADDR A:0x61f0b620
y.create.l HWIO_GFX_SMMU_CB0_TLBIVAL_HIGH_2_GFX_ADDR A:0x61f08624
y.create.l HWIO_GFX_SMMU_CB1_TLBIVAL_HIGH_2_GFX_ADDR A:0x61f09624
y.create.l HWIO_GFX_SMMU_CB2_TLBIVAL_HIGH_2_GFX_ADDR A:0x61f0a624
y.create.l HWIO_GFX_SMMU_CB3_TLBIVAL_HIGH_2_GFX_ADDR A:0x61f0b624
y.create.l HWIO_GFX_SMMU_CB0_TLBIVAAL_LOW_2_GFX_ADDR A:0x61f08628
y.create.l HWIO_GFX_SMMU_CB1_TLBIVAAL_LOW_2_GFX_ADDR A:0x61f09628
y.create.l HWIO_GFX_SMMU_CB2_TLBIVAAL_LOW_2_GFX_ADDR A:0x61f0a628
y.create.l HWIO_GFX_SMMU_CB3_TLBIVAAL_LOW_2_GFX_ADDR A:0x61f0b628
y.create.l HWIO_GFX_SMMU_CB0_TLBIVAAL_HIGH_2_GFX_ADDR A:0x61f0862c
y.create.l HWIO_GFX_SMMU_CB1_TLBIVAAL_HIGH_2_GFX_ADDR A:0x61f0962c
y.create.l HWIO_GFX_SMMU_CB2_TLBIVAAL_HIGH_2_GFX_ADDR A:0x61f0a62c
y.create.l HWIO_GFX_SMMU_CB3_TLBIVAAL_HIGH_2_GFX_ADDR A:0x61f0b62c
y.create.l HWIO_GFX_SMMU_CB0_TLBIIPAS2_LOW_2_GFX_ADDR A:0x61f08630
y.create.l HWIO_GFX_SMMU_CB1_TLBIIPAS2_LOW_2_GFX_ADDR A:0x61f09630
y.create.l HWIO_GFX_SMMU_CB2_TLBIIPAS2_LOW_2_GFX_ADDR A:0x61f0a630
y.create.l HWIO_GFX_SMMU_CB3_TLBIIPAS2_LOW_2_GFX_ADDR A:0x61f0b630
y.create.l HWIO_GFX_SMMU_CB0_TLBIIPAS2_HIGH_2_GFX_ADDR A:0x61f08634
y.create.l HWIO_GFX_SMMU_CB1_TLBIIPAS2_HIGH_2_GFX_ADDR A:0x61f09634
y.create.l HWIO_GFX_SMMU_CB2_TLBIIPAS2_HIGH_2_GFX_ADDR A:0x61f0a634
y.create.l HWIO_GFX_SMMU_CB3_TLBIIPAS2_HIGH_2_GFX_ADDR A:0x61f0b634
y.create.l HWIO_GFX_SMMU_CB0_TLBIIPAS2L_LOW_2_GFX_ADDR A:0x61f08638
y.create.l HWIO_GFX_SMMU_CB1_TLBIIPAS2L_LOW_2_GFX_ADDR A:0x61f09638
y.create.l HWIO_GFX_SMMU_CB2_TLBIIPAS2L_LOW_2_GFX_ADDR A:0x61f0a638
y.create.l HWIO_GFX_SMMU_CB3_TLBIIPAS2L_LOW_2_GFX_ADDR A:0x61f0b638
y.create.l HWIO_GFX_SMMU_CB0_TLBIIPAS2L_HIGH_2_GFX_ADDR A:0x61f0863c
y.create.l HWIO_GFX_SMMU_CB1_TLBIIPAS2L_HIGH_2_GFX_ADDR A:0x61f0963c
y.create.l HWIO_GFX_SMMU_CB2_TLBIIPAS2L_HIGH_2_GFX_ADDR A:0x61f0a63c
y.create.l HWIO_GFX_SMMU_CB3_TLBIIPAS2L_HIGH_2_GFX_ADDR A:0x61f0b63c
y.create.l HWIO_GFX_SMMU_CB0_TLBSYNC_2_GFX_ADDR A:0x61f087f0
y.create.l HWIO_GFX_SMMU_CB1_TLBSYNC_2_GFX_ADDR A:0x61f097f0
y.create.l HWIO_GFX_SMMU_CB2_TLBSYNC_2_GFX_ADDR A:0x61f0a7f0
y.create.l HWIO_GFX_SMMU_CB3_TLBSYNC_2_GFX_ADDR A:0x61f0b7f0
y.create.l HWIO_GFX_SMMU_CB0_TLBSTATUS_2_GFX_ADDR A:0x61f087f4
y.create.l HWIO_GFX_SMMU_CB1_TLBSTATUS_2_GFX_ADDR A:0x61f097f4
y.create.l HWIO_GFX_SMMU_CB2_TLBSTATUS_2_GFX_ADDR A:0x61f0a7f4
y.create.l HWIO_GFX_SMMU_CB3_TLBSTATUS_2_GFX_ADDR A:0x61f0b7f4
y.create.l HWIO_GFX_SMMU_CB0_PMEVCNTR0_2_GFX_ADDR A:0x61f08e00
y.create.l HWIO_GFX_SMMU_CB1_PMEVCNTR0_2_GFX_ADDR A:0x61f09e00
y.create.l HWIO_GFX_SMMU_CB2_PMEVCNTR0_2_GFX_ADDR A:0x61f0ae00
y.create.l HWIO_GFX_SMMU_CB3_PMEVCNTR0_2_GFX_ADDR A:0x61f0be00
y.create.l HWIO_GFX_SMMU_CB0_PMEVCNTR1_2_GFX_ADDR A:0x61f08e04
y.create.l HWIO_GFX_SMMU_CB1_PMEVCNTR1_2_GFX_ADDR A:0x61f09e04
y.create.l HWIO_GFX_SMMU_CB2_PMEVCNTR1_2_GFX_ADDR A:0x61f0ae04
y.create.l HWIO_GFX_SMMU_CB3_PMEVCNTR1_2_GFX_ADDR A:0x61f0be04
y.create.l HWIO_GFX_SMMU_CB0_PMEVCNTR2_2_GFX_ADDR A:0x61f08e08
y.create.l HWIO_GFX_SMMU_CB1_PMEVCNTR2_2_GFX_ADDR A:0x61f09e08
y.create.l HWIO_GFX_SMMU_CB2_PMEVCNTR2_2_GFX_ADDR A:0x61f0ae08
y.create.l HWIO_GFX_SMMU_CB3_PMEVCNTR2_2_GFX_ADDR A:0x61f0be08
y.create.l HWIO_GFX_SMMU_CB0_PMEVCNTR3_2_GFX_ADDR A:0x61f08e0c
y.create.l HWIO_GFX_SMMU_CB1_PMEVCNTR3_2_GFX_ADDR A:0x61f09e0c
y.create.l HWIO_GFX_SMMU_CB2_PMEVCNTR3_2_GFX_ADDR A:0x61f0ae0c
y.create.l HWIO_GFX_SMMU_CB3_PMEVCNTR3_2_GFX_ADDR A:0x61f0be0c
y.create.l HWIO_GFX_SMMU_CB0_PMEVTYPER0_2_GFX_ADDR A:0x61f08e80
y.create.l HWIO_GFX_SMMU_CB1_PMEVTYPER0_2_GFX_ADDR A:0x61f09e80
y.create.l HWIO_GFX_SMMU_CB2_PMEVTYPER0_2_GFX_ADDR A:0x61f0ae80
y.create.l HWIO_GFX_SMMU_CB3_PMEVTYPER0_2_GFX_ADDR A:0x61f0be80
y.create.l HWIO_GFX_SMMU_CB0_PMEVTYPER1_2_GFX_ADDR A:0x61f08e84
y.create.l HWIO_GFX_SMMU_CB1_PMEVTYPER1_2_GFX_ADDR A:0x61f09e84
y.create.l HWIO_GFX_SMMU_CB2_PMEVTYPER1_2_GFX_ADDR A:0x61f0ae84
y.create.l HWIO_GFX_SMMU_CB3_PMEVTYPER1_2_GFX_ADDR A:0x61f0be84
y.create.l HWIO_GFX_SMMU_CB0_PMEVTYPER2_2_GFX_ADDR A:0x61f08e88
y.create.l HWIO_GFX_SMMU_CB1_PMEVTYPER2_2_GFX_ADDR A:0x61f09e88
y.create.l HWIO_GFX_SMMU_CB2_PMEVTYPER2_2_GFX_ADDR A:0x61f0ae88
y.create.l HWIO_GFX_SMMU_CB3_PMEVTYPER2_2_GFX_ADDR A:0x61f0be88
y.create.l HWIO_GFX_SMMU_CB0_PMEVTYPER3_2_GFX_ADDR A:0x61f08e8c
y.create.l HWIO_GFX_SMMU_CB1_PMEVTYPER3_2_GFX_ADDR A:0x61f09e8c
y.create.l HWIO_GFX_SMMU_CB2_PMEVTYPER3_2_GFX_ADDR A:0x61f0ae8c
y.create.l HWIO_GFX_SMMU_CB3_PMEVTYPER3_2_GFX_ADDR A:0x61f0be8c
y.create.l HWIO_GFX_SMMU_CB0_PMCFGR_2_GFX_ADDR A:0x61f08f00
y.create.l HWIO_GFX_SMMU_CB1_PMCFGR_2_GFX_ADDR A:0x61f09f00
y.create.l HWIO_GFX_SMMU_CB2_PMCFGR_2_GFX_ADDR A:0x61f0af00
y.create.l HWIO_GFX_SMMU_CB3_PMCFGR_2_GFX_ADDR A:0x61f0bf00
y.create.l HWIO_GFX_SMMU_CB0_PMCR_2_GFX_ADDR A:0x61f08f04
y.create.l HWIO_GFX_SMMU_CB1_PMCR_2_GFX_ADDR A:0x61f09f04
y.create.l HWIO_GFX_SMMU_CB2_PMCR_2_GFX_ADDR A:0x61f0af04
y.create.l HWIO_GFX_SMMU_CB3_PMCR_2_GFX_ADDR A:0x61f0bf04
y.create.l HWIO_GFX_SMMU_CB0_PMCEID_2_GFX_ADDR A:0x61f08f20
y.create.l HWIO_GFX_SMMU_CB1_PMCEID_2_GFX_ADDR A:0x61f09f20
y.create.l HWIO_GFX_SMMU_CB2_PMCEID_2_GFX_ADDR A:0x61f0af20
y.create.l HWIO_GFX_SMMU_CB3_PMCEID_2_GFX_ADDR A:0x61f0bf20
y.create.l HWIO_GFX_SMMU_CB0_PMCNTENSE_2_GFX_ADDR A:0x61f08f40
y.create.l HWIO_GFX_SMMU_CB1_PMCNTENSE_2_GFX_ADDR A:0x61f09f40
y.create.l HWIO_GFX_SMMU_CB2_PMCNTENSE_2_GFX_ADDR A:0x61f0af40
y.create.l HWIO_GFX_SMMU_CB3_PMCNTENSE_2_GFX_ADDR A:0x61f0bf40
y.create.l HWIO_GFX_SMMU_CB0_PMCNTENCLR_2_GFX_ADDR A:0x61f08f44
y.create.l HWIO_GFX_SMMU_CB1_PMCNTENCLR_2_GFX_ADDR A:0x61f09f44
y.create.l HWIO_GFX_SMMU_CB2_PMCNTENCLR_2_GFX_ADDR A:0x61f0af44
y.create.l HWIO_GFX_SMMU_CB3_PMCNTENCLR_2_GFX_ADDR A:0x61f0bf44
y.create.l HWIO_GFX_SMMU_CB0_PMCNTENSET_2_GFX_ADDR A:0x61f08f48
y.create.l HWIO_GFX_SMMU_CB1_PMCNTENSET_2_GFX_ADDR A:0x61f09f48
y.create.l HWIO_GFX_SMMU_CB2_PMCNTENSET_2_GFX_ADDR A:0x61f0af48
y.create.l HWIO_GFX_SMMU_CB3_PMCNTENSET_2_GFX_ADDR A:0x61f0bf48
y.create.l HWIO_GFX_SMMU_CB0_PMINTENCLR_2_GFX_ADDR A:0x61f08f4c
y.create.l HWIO_GFX_SMMU_CB1_PMINTENCLR_2_GFX_ADDR A:0x61f09f4c
y.create.l HWIO_GFX_SMMU_CB2_PMINTENCLR_2_GFX_ADDR A:0x61f0af4c
y.create.l HWIO_GFX_SMMU_CB3_PMINTENCLR_2_GFX_ADDR A:0x61f0bf4c
y.create.l HWIO_GFX_SMMU_CB0_PMOVSCLR_2_GFX_ADDR A:0x61f08f50
y.create.l HWIO_GFX_SMMU_CB1_PMOVSCLR_2_GFX_ADDR A:0x61f09f50
y.create.l HWIO_GFX_SMMU_CB2_PMOVSCLR_2_GFX_ADDR A:0x61f0af50
y.create.l HWIO_GFX_SMMU_CB3_PMOVSCLR_2_GFX_ADDR A:0x61f0bf50
y.create.l HWIO_GFX_SMMU_CB0_PMOVSSET_2_GFX_ADDR A:0x61f08f58
y.create.l HWIO_GFX_SMMU_CB1_PMOVSSET_2_GFX_ADDR A:0x61f09f58
y.create.l HWIO_GFX_SMMU_CB2_PMOVSSET_2_GFX_ADDR A:0x61f0af58
y.create.l HWIO_GFX_SMMU_CB3_PMOVSSET_2_GFX_ADDR A:0x61f0bf58
y.create.l HWIO_GFX_SMMU_CB0_PMAUTHSTATUS_2_GFX_ADDR A:0x61f08fb8
y.create.l HWIO_GFX_SMMU_CB1_PMAUTHSTATUS_2_GFX_ADDR A:0x61f09fb8
y.create.l HWIO_GFX_SMMU_CB2_PMAUTHSTATUS_2_GFX_ADDR A:0x61f0afb8
y.create.l HWIO_GFX_SMMU_CB3_PMAUTHSTATUS_2_GFX_ADDR A:0x61f0bfb8
y.create.l HWIO_SNOC_0_ABT_HW_VERSION_ADDR A:0x68801000
y.create.l HWIO_SNOC_0_ABT_INST_ID_ADDR A:0x68801004
y.create.l HWIO_SNOC_0_ABT_NUM_SLAVES_ADDR A:0x68801008
y.create.l HWIO_SNOC_0_ABT_TIMER_LOADVAL_ADDR A:0x6880100c
y.create.l HWIO_SNOC_0_ABT_TIMER_MODE_ADDR A:0x68801010
y.create.l HWIO_SNOC_0_ABT_INTR_STATUS_ADDR A:0x68801014
y.create.l HWIO_SNOC_0_ABT_INTR_CLEAR_ADDR A:0x68801018
y.create.l HWIO_SNOC_0_ABT_INTR_ENABLE_ADDR A:0x6880101c
y.create.l HWIO_SNOC_0_ABT_SYND_VALID_ADDR A:0x68801020
y.create.l HWIO_SNOC_0_ABT_SYND_CLEAR_ADDR A:0x68801024
y.create.l HWIO_SNOC_0_ABT_SYND_ID_ADDR A:0x68801028
y.create.l HWIO_SNOC_0_ABT_SYND_ADDR0_ADDR A:0x6880102c
y.create.l HWIO_SNOC_0_ABT_SYND_ADDR1_ADDR A:0x68801030
y.create.l HWIO_SNOC_0_ABT_SYND_HREADY_ADDR A:0x68801034
y.create.l HWIO_SNOC_1_ABT_HW_VERSION_ADDR A:0x68800000
y.create.l HWIO_SNOC_1_ABT_INST_ID_ADDR A:0x68800004
y.create.l HWIO_SNOC_1_ABT_NUM_SLAVES_ADDR A:0x68800008
y.create.l HWIO_SNOC_1_ABT_TIMER_LOADVAL_ADDR A:0x6880000c
y.create.l HWIO_SNOC_1_ABT_TIMER_MODE_ADDR A:0x68800010
y.create.l HWIO_SNOC_1_ABT_INTR_STATUS_ADDR A:0x68800014
y.create.l HWIO_SNOC_1_ABT_INTR_CLEAR_ADDR A:0x68800018
y.create.l HWIO_SNOC_1_ABT_INTR_ENABLE_ADDR A:0x6880001c
y.create.l HWIO_SNOC_1_ABT_SYND_VALID_ADDR A:0x68800020
y.create.l HWIO_SNOC_1_ABT_SYND_CLEAR_ADDR A:0x68800024
y.create.l HWIO_SNOC_1_ABT_SYND_ID_ADDR A:0x68800028
y.create.l HWIO_SNOC_1_ABT_SYND_ADDR0_ADDR A:0x6880002c
y.create.l HWIO_SNOC_1_ABT_SYND_ADDR1_ADDR A:0x68800030
y.create.l HWIO_SNOC_1_ABT_SYND_HREADY_ADDR A:0x68800034
y.create.l HWIO_SPDM_CREG_CFG0_ADDR A:0x60040000
y.create.l HWIO_SPDM_CREG_HW_INFO_ADDR A:0x60040004
y.create.l HWIO_SPDM_CREG_HW_VERSION_ADDR A:0x60040008
y.create.l HWIO_SPDM_CREG_MUTEX_0_ADDR A:0x60040100
y.create.l HWIO_SPDM_OLEM_CFG0_ADDR A:0x60041000
y.create.l HWIO_SPDM_OLEM_CFG1_ADDR A:0x60041004
y.create.l HWIO_SPDM_OLEM_CFG2_ADDR A:0x60041008
y.create.l HWIO_SPDM_OLEM_CFG3_ADDR A:0x6004100c
y.create.l HWIO_SPDM_OLEM_CFG4_ADDR A:0x60041010
y.create.l HWIO_SPDM_OLEM_CFG5_ADDR A:0x60041014
y.create.l HWIO_SPDM_OLEM_CFG6_ADDR A:0x60041018
y.create.l HWIO_SPDM_OLEM_CYCLE_C0_OUT_ADDR A:0x60041020
y.create.l HWIO_SPDM_OLEM_CYCLE_C1_OUT_ADDR A:0x60041024
y.create.l HWIO_SPDM_OLEM_CYCLE_C2_OUT_ADDR A:0x60041028
y.create.l HWIO_SPDM_OLEM_CYCLE_C3_OUT_ADDR A:0x6004102c
y.create.l HWIO_SPDM_OLEM_CYCLE_C4_OUT_ADDR A:0x60041030
y.create.l HWIO_SPDM_OLEM_CYCLE_C5_OUT_ADDR A:0x60041034
y.create.l HWIO_SPDM_OLEM_CYCLE_C6_OUT_ADDR A:0x60041038
y.create.l HWIO_SPDM_OLEM_CYCLE_C7_OUT_ADDR A:0x6004103c
y.create.l HWIO_SPDM_OLEM_CYCLE_C8_OUT_ADDR A:0x60041040
y.create.l HWIO_SPDM_OLEM_CYCLE_C9_OUT_ADDR A:0x60041044
y.create.l HWIO_SPDM_OLEM_EVENT_C0_OUT_ADDR A:0x600410a0
y.create.l HWIO_SPDM_OLEM_EVENT_C1_OUT_ADDR A:0x600410a4
y.create.l HWIO_SPDM_OLEM_EVENT_C2_OUT_ADDR A:0x600410a8
y.create.l HWIO_SPDM_OLEM_EVENT_C3_OUT_ADDR A:0x600410ac
y.create.l HWIO_SPDM_OLEM_EVENT_C4_OUT_ADDR A:0x600410b0
y.create.l HWIO_SPDM_OLEM_EVENT_C5_OUT_ADDR A:0x600410b4
y.create.l HWIO_SPDM_OLEM_EVENT_C6_OUT_ADDR A:0x600410b8
y.create.l HWIO_SPDM_OLEM_EVENT_C7_OUT_ADDR A:0x600410bc
y.create.l HWIO_SPDM_OLEM_EVENT_C8_OUT_ADDR A:0x600410c0
y.create.l HWIO_SPDM_OLEM_EVENT_C9_OUT_ADDR A:0x600410c4
y.create.l HWIO_SPDM_OLEM_MULTIBIT_C0_OUT_ADDR A:0x60041120
y.create.l HWIO_SPDM_OLEM_MULTIBIT_C1_OUT_ADDR A:0x60041124
y.create.l HWIO_SPDM_OLEM_MULTIBIT_C2_OUT_ADDR A:0x60041128
y.create.l HWIO_SPDM_OLEM_MULTIBIT_C3_OUT_ADDR A:0x6004112c
y.create.l HWIO_SPDM_OLEM_MULTIBIT_C4_OUT_ADDR A:0x60041130
y.create.l HWIO_SPDM_OLEM_MULTIBIT_C5_OUT_ADDR A:0x60041134
y.create.l HWIO_SPDM_OLEM_MULTIBIT_C6_OUT_ADDR A:0x60041138
y.create.l HWIO_SPDM_OLEM_MULTIBIT_C7_OUT_ADDR A:0x6004113c
y.create.l HWIO_SPDM_RT_LOW_THRESH_STATUS_ADDR A:0x60042000
y.create.l HWIO_SPDM_RT_HIGH_THRESH_STATUS_ADDR A:0x60042004
y.create.l HWIO_SPDM_RT_LOW_IRQ_EN_0_ADDR A:0x60042010
y.create.l HWIO_SPDM_RT_LOW_IRQ_EN_1_ADDR A:0x60042014
y.create.l HWIO_SPDM_RT_LOW_IRQ_EN_2_ADDR A:0x60042018
y.create.l HWIO_SPDM_RT_LOW_IRQ_EN_3_ADDR A:0x6004201c
y.create.l HWIO_SPDM_RT_HIGH_IRQ_EN_0_ADDR A:0x60042020
y.create.l HWIO_SPDM_RT_HIGH_IRQ_EN_1_ADDR A:0x60042024
y.create.l HWIO_SPDM_RT_HIGH_IRQ_EN_2_ADDR A:0x60042028
y.create.l HWIO_SPDM_RT_HIGH_IRQ_EN_3_ADDR A:0x6004202c
y.create.l HWIO_SPDM_RT_IRQ_TIMER_0_ADDR A:0x60042030
y.create.l HWIO_SPDM_RT_IRQ_TIMER_1_ADDR A:0x60042034
y.create.l HWIO_SPDM_RT_IRQ_TIMER_2_ADDR A:0x60042038
y.create.l HWIO_SPDM_RT_IRQ_TIMER_3_ADDR A:0x6004203c
y.create.l HWIO_SPDM_RT_DIAG_MUX_SEL_ADDR A:0x60042040
y.create.l HWIO_SPDM_RT_MON_EN_ADDR A:0x60042050
y.create.l HWIO_SPDM_RT_MON_EN_SET_ADDR A:0x60042054
y.create.l HWIO_SPDM_RT_MON_EN_CLEAR_ADDR A:0x60042058
y.create.l HWIO_SPDM_RT_MON_RST_ADDR A:0x60042060
y.create.l HWIO_SPDM_RT_MON_RST_SET_ADDR A:0x60042064
y.create.l HWIO_SPDM_RT_MON_RST_CLEAR_ADDR A:0x60042068
y.create.l HWIO_SPDM_RT_MON_CFG_0_ADDR A:0x60042100
y.create.l HWIO_SPDM_RT_MON_CFG_1_ADDR A:0x60042110
y.create.l HWIO_SPDM_RT_MON_CFG_2_ADDR A:0x60042120
y.create.l HWIO_SPDM_RT_MON_CFG_3_ADDR A:0x60042130
y.create.l HWIO_SPDM_RT_MON_CFG_4_ADDR A:0x60042140
y.create.l HWIO_SPDM_RT_MON_CFG_5_ADDR A:0x60042150
y.create.l HWIO_SPDM_RT_MON_CFG_6_ADDR A:0x60042160
y.create.l HWIO_SPDM_RT_MON_CFG_7_ADDR A:0x60042170
y.create.l HWIO_SPDM_RT_MON_CFG_8_ADDR A:0x60042180
y.create.l HWIO_SPDM_RT_MON_CFG_9_ADDR A:0x60042190
y.create.l HWIO_SPDM_RT_THRESH_CFG_0_ADDR A:0x60042104
y.create.l HWIO_SPDM_RT_THRESH_CFG_1_ADDR A:0x60042114
y.create.l HWIO_SPDM_RT_THRESH_CFG_2_ADDR A:0x60042124
y.create.l HWIO_SPDM_RT_THRESH_CFG_3_ADDR A:0x60042134
y.create.l HWIO_SPDM_RT_THRESH_CFG_4_ADDR A:0x60042144
y.create.l HWIO_SPDM_RT_THRESH_CFG_5_ADDR A:0x60042154
y.create.l HWIO_SPDM_RT_THRESH_CFG_6_ADDR A:0x60042164
y.create.l HWIO_SPDM_RT_THRESH_CFG_7_ADDR A:0x60042174
y.create.l HWIO_SPDM_RT_THRESH_CFG_8_ADDR A:0x60042184
y.create.l HWIO_SPDM_RT_THRESH_CFG_9_ADDR A:0x60042194
y.create.l HWIO_SPDM_RT_MON_STATUS_0_ADDR A:0x60042108
y.create.l HWIO_SPDM_RT_MON_STATUS_1_ADDR A:0x60042118
y.create.l HWIO_SPDM_RT_MON_STATUS_2_ADDR A:0x60042128
y.create.l HWIO_SPDM_RT_MON_STATUS_3_ADDR A:0x60042138
y.create.l HWIO_SPDM_RT_MON_STATUS_4_ADDR A:0x60042148
y.create.l HWIO_SPDM_RT_MON_STATUS_5_ADDR A:0x60042158
y.create.l HWIO_SPDM_RT_MON_STATUS_6_ADDR A:0x60042168
y.create.l HWIO_SPDM_RT_MON_STATUS_7_ADDR A:0x60042178
y.create.l HWIO_SPDM_RT_MON_STATUS_8_ADDR A:0x60042188
y.create.l HWIO_SPDM_RT_MON_STATUS_9_ADDR A:0x60042198
y.create.l HWIO_SPDM_SREG_CFG0_ADDR A:0x60044000
y.create.l HWIO_SPDM_SREG_CFG1_ADDR A:0x60044004
y.create.l HWIO_SPDM_SREG_MUTEX_0_ADDR A:0x60044100
y.create.l HWIO_SNOC_OBS_ID_COREID_ADDR A:0x60580000
y.create.l HWIO_SNOC_OBS_ID_REVISIONID_ADDR A:0x60580004
y.create.l HWIO_SNOC_OBS_FAULTEN_ADDR A:0x60580008
y.create.l HWIO_SNOC_OBS_ERRVLD_ADDR A:0x6058000c
y.create.l HWIO_SNOC_OBS_ERRCLR_ADDR A:0x60580010
y.create.l HWIO_SNOC_OBS_ERRLOG0_ADDR A:0x60580014
y.create.l HWIO_SNOC_OBS_ERRLOG1_ADDR A:0x60580018
y.create.l HWIO_SNOC_OBS_ERRLOG3_ADDR A:0x60580020
y.create.l HWIO_SNOC_OBS_ERRLOG4_ADDR A:0x60580024
y.create.l HWIO_SNOC_OBS_ERRLOG5_ADDR A:0x60580028
y.create.l HWIO_SNOC_OBS_DBG_ID_COREID_ADDR A:0x60580080
y.create.l HWIO_SNOC_OBS_DBG_ID_REVISIONID_ADDR A:0x60580084
y.create.l HWIO_SNOC_OBS_DBG_ATBID_ADDR A:0x60580088
y.create.l HWIO_SNOC_OBS_DBG_ATBEN_ADDR A:0x6058008c
y.create.l HWIO_SNOC_OBS_DBG_SYNCPERIOD_ADDR A:0x60580090
y.create.l HWIO_SNOC_MSS_TFILT_ID_COREID_ADDR A:0x60581000
y.create.l HWIO_SNOC_MSS_TFILT_ID_REVISIONID_ADDR A:0x60581004
y.create.l HWIO_SNOC_MSS_TFILT_MODE_ADDR A:0x60581008
y.create.l HWIO_SNOC_MSS_TFILT_ADDRBASE_LOW_ADDR A:0x6058100c
y.create.l HWIO_SNOC_MSS_TFILT_ADDRBASE_HIGH_ADDR A:0x60581010
y.create.l HWIO_SNOC_MSS_TFILT_ADDRWINDOWSIZE_ADDR A:0x60581014
y.create.l HWIO_SNOC_MSS_TFILT_SRCIDBASE_ADDR A:0x60581018
y.create.l HWIO_SNOC_MSS_TFILT_SRCIDMASK_ADDR A:0x6058101c
y.create.l HWIO_SNOC_MSS_TFILT_OPCODE_ADDR A:0x60581020
y.create.l HWIO_SNOC_MSS_TFILT_USERBASE_ADDR A:0x60581024
y.create.l HWIO_SNOC_MSS_TFILT_USERMASK_ADDR A:0x60581028
y.create.l HWIO_SNOC_MSS_NAV_TFILT_ID_COREID_ADDR A:0x60581080
y.create.l HWIO_SNOC_MSS_NAV_TFILT_ID_REVISIONID_ADDR A:0x60581084
y.create.l HWIO_SNOC_MSS_NAV_TFILT_MODE_ADDR A:0x60581088
y.create.l HWIO_SNOC_MSS_NAV_TFILT_ADDRBASE_LOW_ADDR A:0x6058108c
y.create.l HWIO_SNOC_MSS_NAV_TFILT_ADDRBASE_HIGH_ADDR A:0x60581090
y.create.l HWIO_SNOC_MSS_NAV_TFILT_ADDRWINDOWSIZE_ADDR A:0x60581094
y.create.l HWIO_SNOC_MSS_NAV_TFILT_SRCIDBASE_ADDR A:0x60581098
y.create.l HWIO_SNOC_MSS_NAV_TFILT_SRCIDMASK_ADDR A:0x6058109c
y.create.l HWIO_SNOC_MSS_NAV_TFILT_OPCODE_ADDR A:0x605810a0
y.create.l HWIO_SNOC_MSS_NAV_TFILT_USERBASE_ADDR A:0x605810a4
y.create.l HWIO_SNOC_MSS_NAV_TFILT_USERMASK_ADDR A:0x605810a8
y.create.l HWIO_SNOC_VENUS0_TFILT_ID_COREID_ADDR A:0x60581100
y.create.l HWIO_SNOC_VENUS0_TFILT_ID_REVISIONID_ADDR A:0x60581104
y.create.l HWIO_SNOC_VENUS0_TFILT_MODE_ADDR A:0x60581108
y.create.l HWIO_SNOC_VENUS0_TFILT_ADDRBASE_LOW_ADDR A:0x6058110c
y.create.l HWIO_SNOC_VENUS0_TFILT_ADDRBASE_HIGH_ADDR A:0x60581110
y.create.l HWIO_SNOC_VENUS0_TFILT_ADDRWINDOWSIZE_ADDR A:0x60581114
y.create.l HWIO_SNOC_VENUS0_TFILT_SRCIDBASE_ADDR A:0x60581118
y.create.l HWIO_SNOC_VENUS0_TFILT_SRCIDMASK_ADDR A:0x6058111c
y.create.l HWIO_SNOC_VENUS0_TFILT_OPCODE_ADDR A:0x60581120
y.create.l HWIO_SNOC_VENUS0_TFILT_USERBASE_ADDR A:0x60581124
y.create.l HWIO_SNOC_VENUS0_TFILT_USERMASK_ADDR A:0x60581128
y.create.l HWIO_SNOC_VFE_TFILT_ID_COREID_ADDR A:0x60581180
y.create.l HWIO_SNOC_VFE_TFILT_ID_REVISIONID_ADDR A:0x60581184
y.create.l HWIO_SNOC_VFE_TFILT_MODE_ADDR A:0x60581188
y.create.l HWIO_SNOC_VFE_TFILT_ADDRBASE_LOW_ADDR A:0x6058118c
y.create.l HWIO_SNOC_VFE_TFILT_ADDRBASE_HIGH_ADDR A:0x60581190
y.create.l HWIO_SNOC_VFE_TFILT_ADDRWINDOWSIZE_ADDR A:0x60581194
y.create.l HWIO_SNOC_VFE_TFILT_SRCIDBASE_ADDR A:0x60581198
y.create.l HWIO_SNOC_VFE_TFILT_SRCIDMASK_ADDR A:0x6058119c
y.create.l HWIO_SNOC_VFE_TFILT_OPCODE_ADDR A:0x605811a0
y.create.l HWIO_SNOC_VFE_TFILT_USERBASE_ADDR A:0x605811a4
y.create.l HWIO_SNOC_VFE_TFILT_USERMASK_ADDR A:0x605811a8
y.create.l HWIO_SNOC_QDSS_BAM_TFILT_ID_COREID_ADDR A:0x60581200
y.create.l HWIO_SNOC_QDSS_BAM_TFILT_ID_REVISIONID_ADDR A:0x60581204
y.create.l HWIO_SNOC_QDSS_BAM_TFILT_MODE_ADDR A:0x60581208
y.create.l HWIO_SNOC_QDSS_BAM_TFILT_ADDRBASE_LOW_ADDR A:0x6058120c
y.create.l HWIO_SNOC_QDSS_BAM_TFILT_ADDRWINDOWSIZE_ADDR A:0x60581214
y.create.l HWIO_SNOC_QDSS_BAM_TFILT_SRCIDBASE_ADDR A:0x60581218
y.create.l HWIO_SNOC_QDSS_BAM_TFILT_SRCIDMASK_ADDR A:0x6058121c
y.create.l HWIO_SNOC_QDSS_BAM_TFILT_OPCODE_ADDR A:0x60581220
y.create.l HWIO_SNOC_QDSS_BAM_TFILT_USERBASE_ADDR A:0x60581224
y.create.l HWIO_SNOC_QDSS_BAM_TFILT_USERMASK_ADDR A:0x60581228
y.create.l HWIO_SNOC_PCNOC_TFILT_ID_COREID_ADDR A:0x60581280
y.create.l HWIO_SNOC_PCNOC_TFILT_ID_REVISIONID_ADDR A:0x60581284
y.create.l HWIO_SNOC_PCNOC_TFILT_MODE_ADDR A:0x60581288
y.create.l HWIO_SNOC_PCNOC_TFILT_ADDRBASE_LOW_ADDR A:0x6058128c
y.create.l HWIO_SNOC_PCNOC_TFILT_ADDRBASE_HIGH_ADDR A:0x60581290
y.create.l HWIO_SNOC_PCNOC_TFILT_ADDRWINDOWSIZE_ADDR A:0x60581294
y.create.l HWIO_SNOC_PCNOC_TFILT_SRCIDBASE_ADDR A:0x60581298
y.create.l HWIO_SNOC_PCNOC_TFILT_SRCIDMASK_ADDR A:0x6058129c
y.create.l HWIO_SNOC_PCNOC_TFILT_OPCODE_ADDR A:0x605812a0
y.create.l HWIO_SNOC_PCNOC_TFILT_USERBASE_ADDR A:0x605812a4
y.create.l HWIO_SNOC_PCNOC_TFILT_USERMASK_ADDR A:0x605812a8
y.create.l HWIO_SNOC_BIMC_TFILT_ID_COREID_ADDR A:0x60581300
y.create.l HWIO_SNOC_BIMC_TFILT_ID_REVISIONID_ADDR A:0x60581304
y.create.l HWIO_SNOC_BIMC_TFILT_MODE_ADDR A:0x60581308
y.create.l HWIO_SNOC_BIMC_TFILT_ADDRBASE_LOW_ADDR A:0x6058130c
y.create.l HWIO_SNOC_BIMC_TFILT_ADDRBASE_HIGH_ADDR A:0x60581310
y.create.l HWIO_SNOC_BIMC_TFILT_ADDRWINDOWSIZE_ADDR A:0x60581314
y.create.l HWIO_SNOC_BIMC_TFILT_SRCIDBASE_ADDR A:0x60581318
y.create.l HWIO_SNOC_BIMC_TFILT_SRCIDMASK_ADDR A:0x6058131c
y.create.l HWIO_SNOC_BIMC_TFILT_OPCODE_ADDR A:0x60581320
y.create.l HWIO_SNOC_BIMC_TFILT_USERBASE_ADDR A:0x60581324
y.create.l HWIO_SNOC_BIMC_TFILT_USERMASK_ADDR A:0x60581328
y.create.l HWIO_SNOC_WCSS_TFILT_ID_COREID_ADDR A:0x60581380
y.create.l HWIO_SNOC_WCSS_TFILT_ID_REVISIONID_ADDR A:0x60581384
y.create.l HWIO_SNOC_WCSS_TFILT_MODE_ADDR A:0x60581388
y.create.l HWIO_SNOC_WCSS_TFILT_ADDRBASE_LOW_ADDR A:0x6058138c
y.create.l HWIO_SNOC_WCSS_TFILT_ADDRBASE_HIGH_ADDR A:0x60581390
y.create.l HWIO_SNOC_WCSS_TFILT_ADDRWINDOWSIZE_ADDR A:0x60581394
y.create.l HWIO_SNOC_WCSS_TFILT_SRCIDBASE_ADDR A:0x60581398
y.create.l HWIO_SNOC_WCSS_TFILT_SRCIDMASK_ADDR A:0x6058139c
y.create.l HWIO_SNOC_WCSS_TFILT_OPCODE_ADDR A:0x605813a0
y.create.l HWIO_SNOC_WCSS_TFILT_USERBASE_ADDR A:0x605813a4
y.create.l HWIO_SNOC_WCSS_TFILT_USERMASK_ADDR A:0x605813a8
y.create.l HWIO_SNOC_QDSS_ETR_TFILT_ID_COREID_ADDR A:0x60581400
y.create.l HWIO_SNOC_QDSS_ETR_TFILT_ID_REVISIONID_ADDR A:0x60581404
y.create.l HWIO_SNOC_QDSS_ETR_TFILT_MODE_ADDR A:0x60581408
y.create.l HWIO_SNOC_QDSS_ETR_TFILT_ADDRBASE_LOW_ADDR A:0x6058140c
y.create.l HWIO_SNOC_QDSS_ETR_TFILT_ADDRWINDOWSIZE_ADDR A:0x60581414
y.create.l HWIO_SNOC_QDSS_ETR_TFILT_SRCIDBASE_ADDR A:0x60581418
y.create.l HWIO_SNOC_QDSS_ETR_TFILT_SRCIDMASK_ADDR A:0x6058141c
y.create.l HWIO_SNOC_QDSS_ETR_TFILT_OPCODE_ADDR A:0x60581420
y.create.l HWIO_SNOC_QDSS_ETR_TFILT_USERBASE_ADDR A:0x60581424
y.create.l HWIO_SNOC_QDSS_ETR_TFILT_USERMASK_ADDR A:0x60581428
y.create.l HWIO_SNOC_MDP0_TFILT_ID_COREID_ADDR A:0x60581500
y.create.l HWIO_SNOC_MDP0_TFILT_ID_REVISIONID_ADDR A:0x60581504
y.create.l HWIO_SNOC_MDP0_TFILT_MODE_ADDR A:0x60581508
y.create.l HWIO_SNOC_MDP0_TFILT_ADDRBASE_LOW_ADDR A:0x6058150c
y.create.l HWIO_SNOC_MDP0_TFILT_ADDRBASE_HIGH_ADDR A:0x60581510
y.create.l HWIO_SNOC_MDP0_TFILT_ADDRWINDOWSIZE_ADDR A:0x60581514
y.create.l HWIO_SNOC_MDP0_TFILT_SRCIDBASE_ADDR A:0x60581518
y.create.l HWIO_SNOC_MDP0_TFILT_SRCIDMASK_ADDR A:0x6058151c
y.create.l HWIO_SNOC_MDP0_TFILT_OPCODE_ADDR A:0x60581520
y.create.l HWIO_SNOC_MDP0_TFILT_USERBASE_ADDR A:0x60581524
y.create.l HWIO_SNOC_MDP0_TFILT_USERMASK_ADDR A:0x60581528
y.create.l HWIO_SNOC_TPRB0_TPROF_ID_COREID_ADDR A:0x60582000
y.create.l HWIO_SNOC_TPRB0_TPROF_ID_REVISIONID_ADDR A:0x60582004
y.create.l HWIO_SNOC_TPRB0_TPROF_EN_ADDR A:0x60582008
y.create.l HWIO_SNOC_TPRB0_TPROF_MODE_ADDR A:0x6058200c
y.create.l HWIO_SNOC_TPRB0_TPROF_OBSERVEDSEL_0_ADDR A:0x60582010
y.create.l HWIO_SNOC_TPRB0_TPROF_OBSERVEDSEL_1_ADDR A:0x60582014
y.create.l HWIO_SNOC_TPRB0_TPROF_NTENURELINES_0_ADDR A:0x60582020
y.create.l HWIO_SNOC_TPRB0_TPROF_THRESHOLDS_0_0_ADDR A:0x6058202c
y.create.l HWIO_SNOC_TPRB0_TPROF_THRESHOLDS_0_1_ADDR A:0x60582030
y.create.l HWIO_SNOC_TPRB0_TPROF_THRESHOLDS_0_2_ADDR A:0x60582034
y.create.l HWIO_SNOC_TPRB0_TPROF_THRESHOLDS_1_0_ADDR A:0x6058203c
y.create.l HWIO_SNOC_TPRB0_TPROF_THRESHOLDS_1_1_ADDR A:0x60582040
y.create.l HWIO_SNOC_TPRB0_TPROF_THRESHOLDS_1_2_ADDR A:0x60582044
y.create.l HWIO_SNOC_TPRB0_TPROF_OVERFLOWSTATUS_ADDR A:0x6058206c
y.create.l HWIO_SNOC_TPRB0_TPROF_OVERFLOWRESET_ADDR A:0x60582070
y.create.l HWIO_SNOC_TPRB0_TPROF_PENDINGEVENTMODE_ADDR A:0x60582074
y.create.l HWIO_SNOC_TPRB0_TPROF_PRESCALER_ADDR A:0x60582078
y.create.l HWIO_SNOC_TPRB1_TPROF_ID_COREID_ADDR A:0x60582080
y.create.l HWIO_SNOC_TPRB1_TPROF_ID_REVISIONID_ADDR A:0x60582084
y.create.l HWIO_SNOC_TPRB1_TPROF_EN_ADDR A:0x60582088
y.create.l HWIO_SNOC_TPRB1_TPROF_MODE_ADDR A:0x6058208c
y.create.l HWIO_SNOC_TPRB1_TPROF_OBSERVEDSEL_0_ADDR A:0x60582090
y.create.l HWIO_SNOC_TPRB1_TPROF_OBSERVEDSEL_1_ADDR A:0x60582094
y.create.l HWIO_SNOC_TPRB1_TPROF_NTENURELINES_0_ADDR A:0x605820a0
y.create.l HWIO_SNOC_TPRB1_TPROF_THRESHOLDS_0_0_ADDR A:0x605820ac
y.create.l HWIO_SNOC_TPRB1_TPROF_THRESHOLDS_0_1_ADDR A:0x605820b0
y.create.l HWIO_SNOC_TPRB1_TPROF_THRESHOLDS_0_2_ADDR A:0x605820b4
y.create.l HWIO_SNOC_TPRB1_TPROF_THRESHOLDS_1_0_ADDR A:0x605820bc
y.create.l HWIO_SNOC_TPRB1_TPROF_THRESHOLDS_1_1_ADDR A:0x605820c0
y.create.l HWIO_SNOC_TPRB1_TPROF_THRESHOLDS_1_2_ADDR A:0x605820c4
y.create.l HWIO_SNOC_TPRB1_TPROF_OVERFLOWSTATUS_ADDR A:0x605820ec
y.create.l HWIO_SNOC_TPRB1_TPROF_OVERFLOWRESET_ADDR A:0x605820f0
y.create.l HWIO_SNOC_TPRB1_TPROF_PENDINGEVENTMODE_ADDR A:0x605820f4
y.create.l HWIO_SNOC_TPRB1_TPROF_PRESCALER_ADDR A:0x605820f8
y.create.l HWIO_SNOC_TPRB2_TPROF_ID_COREID_ADDR A:0x60582100
y.create.l HWIO_SNOC_TPRB2_TPROF_ID_REVISIONID_ADDR A:0x60582104
y.create.l HWIO_SNOC_TPRB2_TPROF_EN_ADDR A:0x60582108
y.create.l HWIO_SNOC_TPRB2_TPROF_MODE_ADDR A:0x6058210c
y.create.l HWIO_SNOC_TPRB2_TPROF_OBSERVEDSEL_0_ADDR A:0x60582110
y.create.l HWIO_SNOC_TPRB2_TPROF_OBSERVEDSEL_1_ADDR A:0x60582114
y.create.l HWIO_SNOC_TPRB2_TPROF_NTENURELINES_0_ADDR A:0x60582120
y.create.l HWIO_SNOC_TPRB2_TPROF_THRESHOLDS_0_0_ADDR A:0x6058212c
y.create.l HWIO_SNOC_TPRB2_TPROF_THRESHOLDS_0_1_ADDR A:0x60582130
y.create.l HWIO_SNOC_TPRB2_TPROF_THRESHOLDS_0_2_ADDR A:0x60582134
y.create.l HWIO_SNOC_TPRB2_TPROF_THRESHOLDS_1_0_ADDR A:0x6058213c
y.create.l HWIO_SNOC_TPRB2_TPROF_THRESHOLDS_1_1_ADDR A:0x60582140
y.create.l HWIO_SNOC_TPRB2_TPROF_THRESHOLDS_1_2_ADDR A:0x60582144
y.create.l HWIO_SNOC_TPRB2_TPROF_OVERFLOWSTATUS_ADDR A:0x6058216c
y.create.l HWIO_SNOC_TPRB2_TPROF_OVERFLOWRESET_ADDR A:0x60582170
y.create.l HWIO_SNOC_TPRB2_TPROF_PENDINGEVENTMODE_ADDR A:0x60582174
y.create.l HWIO_SNOC_TPRB2_TPROF_PRESCALER_ADDR A:0x60582178
y.create.l HWIO_SNOC_EPRB0_SPROF_ID_COREID_ADDR A:0x60583000
y.create.l HWIO_SNOC_EPRB0_SPROF_ID_REVISIONID_ADDR A:0x60583004
y.create.l HWIO_SNOC_EPRB0_SPROF_MAINCTL_ADDR A:0x60583008
y.create.l HWIO_SNOC_EPRB0_SPROF_CFGCTL_ADDR A:0x6058300c
y.create.l HWIO_SNOC_EPRB0_SPROF_TRACEPORTSEL_ADDR A:0x60583010
y.create.l HWIO_SNOC_EPRB0_SPROF_FILTERLUT_ADDR A:0x60583014
y.create.l HWIO_SNOC_EPRB0_SPROF_TRACEALARMEN_ADDR A:0x60583018
y.create.l HWIO_SNOC_EPRB0_SPROF_TRACEALARMSTATUS_ADDR A:0x6058301c
y.create.l HWIO_SNOC_EPRB0_SPROF_TRACEALARMCLR_ADDR A:0x60583020
y.create.l HWIO_SNOC_EPRB0_SPROF_STATPERIOD_ADDR A:0x60583024
y.create.l HWIO_SNOC_EPRB0_SPROF_STATGO_ADDR A:0x60583028
y.create.l HWIO_SNOC_EPRB0_SPROF_STATALARMMIN_ADDR A:0x6058302c
y.create.l HWIO_SNOC_EPRB0_SPROF_STATALARMMAX_ADDR A:0x60583030
y.create.l HWIO_SNOC_EPRB0_SPROF_STATALARMSTATUS_ADDR A:0x60583034
y.create.l HWIO_SNOC_EPRB0_SPROF_STATALARMCLR_ADDR A:0x60583038
y.create.l HWIO_SNOC_EPRB0_SPROF_STATALARMEN_ADDR A:0x6058303c
y.create.l HWIO_SNOC_EPRB0_SPROF_FILTERS_0_ROUTEIDBASE_ADDR A:0x60583044
y.create.l HWIO_SNOC_EPRB0_SPROF_FILTERS_0_ROUTEIDMASK_ADDR A:0x60583048
y.create.l HWIO_SNOC_EPRB0_SPROF_FILTERS_0_ADDRBASE_LOW_ADDR A:0x6058304c
y.create.l HWIO_SNOC_EPRB0_SPROF_FILTERS_0_ADDRBASE_HIGH_ADDR A:0x60583050
y.create.l HWIO_SNOC_EPRB0_SPROF_FILTERS_0_WINDOWSIZE_ADDR A:0x60583054
y.create.l HWIO_SNOC_EPRB0_SPROF_FILTERS_0_OPCODE_ADDR A:0x60583060
y.create.l HWIO_SNOC_EPRB0_SPROF_FILTERS_0_STATUS_ADDR A:0x60583064
y.create.l HWIO_SNOC_EPRB0_SPROF_FILTERS_0_LENGTH_ADDR A:0x60583068
y.create.l HWIO_SNOC_EPRB0_SPROF_FILTERS_0_URGENCY_ADDR A:0x6058306c
y.create.l HWIO_SNOC_EPRB0_SPROF_FILTERS_1_ROUTEIDBASE_ADDR A:0x60583080
y.create.l HWIO_SNOC_EPRB0_SPROF_FILTERS_1_ROUTEIDMASK_ADDR A:0x60583084
y.create.l HWIO_SNOC_EPRB0_SPROF_FILTERS_1_ADDRBASE_LOW_ADDR A:0x60583088
y.create.l HWIO_SNOC_EPRB0_SPROF_FILTERS_1_ADDRBASE_HIGH_ADDR A:0x6058308c
y.create.l HWIO_SNOC_EPRB0_SPROF_FILTERS_1_WINDOWSIZE_ADDR A:0x60583090
y.create.l HWIO_SNOC_EPRB0_SPROF_FILTERS_1_OPCODE_ADDR A:0x6058309c
y.create.l HWIO_SNOC_EPRB0_SPROF_FILTERS_1_STATUS_ADDR A:0x605830a0
y.create.l HWIO_SNOC_EPRB0_SPROF_FILTERS_1_LENGTH_ADDR A:0x605830a4
y.create.l HWIO_SNOC_EPRB0_SPROF_FILTERS_1_URGENCY_ADDR A:0x605830a8
y.create.l HWIO_SNOC_EPRB0_SPROF_FILTERS_2_ROUTEIDBASE_ADDR A:0x605830bc
y.create.l HWIO_SNOC_EPRB0_SPROF_FILTERS_2_ROUTEIDMASK_ADDR A:0x605830c0
y.create.l HWIO_SNOC_EPRB0_SPROF_FILTERS_2_ADDRBASE_LOW_ADDR A:0x605830c4
y.create.l HWIO_SNOC_EPRB0_SPROF_FILTERS_2_ADDRBASE_HIGH_ADDR A:0x605830c8
y.create.l HWIO_SNOC_EPRB0_SPROF_FILTERS_2_WINDOWSIZE_ADDR A:0x605830cc
y.create.l HWIO_SNOC_EPRB0_SPROF_FILTERS_2_OPCODE_ADDR A:0x605830d8
y.create.l HWIO_SNOC_EPRB0_SPROF_FILTERS_2_STATUS_ADDR A:0x605830dc
y.create.l HWIO_SNOC_EPRB0_SPROF_FILTERS_2_LENGTH_ADDR A:0x605830e0
y.create.l HWIO_SNOC_EPRB0_SPROF_FILTERS_2_URGENCY_ADDR A:0x605830e4
y.create.l HWIO_SNOC_EPRB0_SPROF_FILTERS_3_ROUTEIDBASE_ADDR A:0x605830f8
y.create.l HWIO_SNOC_EPRB0_SPROF_FILTERS_3_ROUTEIDMASK_ADDR A:0x605830fc
y.create.l HWIO_SNOC_EPRB0_SPROF_FILTERS_3_ADDRBASE_LOW_ADDR A:0x60583100
y.create.l HWIO_SNOC_EPRB0_SPROF_FILTERS_3_ADDRBASE_HIGH_ADDR A:0x60583104
y.create.l HWIO_SNOC_EPRB0_SPROF_FILTERS_3_WINDOWSIZE_ADDR A:0x60583108
y.create.l HWIO_SNOC_EPRB0_SPROF_FILTERS_3_OPCODE_ADDR A:0x60583114
y.create.l HWIO_SNOC_EPRB0_SPROF_FILTERS_3_STATUS_ADDR A:0x60583118
y.create.l HWIO_SNOC_EPRB0_SPROF_FILTERS_3_LENGTH_ADDR A:0x6058311c
y.create.l HWIO_SNOC_EPRB0_SPROF_FILTERS_3_URGENCY_ADDR A:0x60583120
y.create.l HWIO_SNOC_EPRB0_SPROF_COUNTERS_0_PORTSEL_ADDR A:0x60583134
y.create.l HWIO_SNOC_EPRB0_SPROF_COUNTERS_0_SRC_ADDR A:0x60583138
y.create.l HWIO_SNOC_EPRB0_SPROF_COUNTERS_0_ALARMMODE_ADDR A:0x6058313c
y.create.l HWIO_SNOC_EPRB0_SPROF_COUNTERS_0_VAL_ADDR A:0x60583140
y.create.l HWIO_SNOC_EPRB0_SPROF_COUNTERS_1_PORTSEL_ADDR A:0x60583148
y.create.l HWIO_SNOC_EPRB0_SPROF_COUNTERS_1_SRC_ADDR A:0x6058314c
y.create.l HWIO_SNOC_EPRB0_SPROF_COUNTERS_1_ALARMMODE_ADDR A:0x60583150
y.create.l HWIO_SNOC_EPRB0_SPROF_COUNTERS_1_VAL_ADDR A:0x60583154
y.create.l HWIO_SNOC_EPRB0_SPROF_COUNTERS_2_PORTSEL_ADDR A:0x6058315c
y.create.l HWIO_SNOC_EPRB0_SPROF_COUNTERS_2_SRC_ADDR A:0x60583160
y.create.l HWIO_SNOC_EPRB0_SPROF_COUNTERS_2_ALARMMODE_ADDR A:0x60583164
y.create.l HWIO_SNOC_EPRB0_SPROF_COUNTERS_2_VAL_ADDR A:0x60583168
y.create.l HWIO_SNOC_EPRB0_SPROF_COUNTERS_3_PORTSEL_ADDR A:0x60583170
y.create.l HWIO_SNOC_EPRB0_SPROF_COUNTERS_3_SRC_ADDR A:0x60583174
y.create.l HWIO_SNOC_EPRB0_SPROF_COUNTERS_3_ALARMMODE_ADDR A:0x60583178
y.create.l HWIO_SNOC_EPRB0_SPROF_COUNTERS_3_VAL_ADDR A:0x6058317c
y.create.l HWIO_SNOC_EPRB0_SPROF_COUNTERS_4_PORTSEL_ADDR A:0x60583184
y.create.l HWIO_SNOC_EPRB0_SPROF_COUNTERS_4_SRC_ADDR A:0x60583188
y.create.l HWIO_SNOC_EPRB0_SPROF_COUNTERS_4_ALARMMODE_ADDR A:0x6058318c
y.create.l HWIO_SNOC_EPRB0_SPROF_COUNTERS_4_VAL_ADDR A:0x60583190
y.create.l HWIO_SNOC_EPRB0_SPROF_COUNTERS_5_PORTSEL_ADDR A:0x60583198
y.create.l HWIO_SNOC_EPRB0_SPROF_COUNTERS_5_SRC_ADDR A:0x6058319c
y.create.l HWIO_SNOC_EPRB0_SPROF_COUNTERS_5_ALARMMODE_ADDR A:0x605831a0
y.create.l HWIO_SNOC_EPRB0_SPROF_COUNTERS_5_VAL_ADDR A:0x605831a4
y.create.l HWIO_SNOC_EPRB0_SPROF_COUNTERS_6_PORTSEL_ADDR A:0x605831ac
y.create.l HWIO_SNOC_EPRB0_SPROF_COUNTERS_6_SRC_ADDR A:0x605831b0
y.create.l HWIO_SNOC_EPRB0_SPROF_COUNTERS_6_ALARMMODE_ADDR A:0x605831b4
y.create.l HWIO_SNOC_EPRB0_SPROF_COUNTERS_6_VAL_ADDR A:0x605831b8
y.create.l HWIO_SNOC_EPRB0_SPROF_COUNTERS_7_PORTSEL_ADDR A:0x605831c0
y.create.l HWIO_SNOC_EPRB0_SPROF_COUNTERS_7_SRC_ADDR A:0x605831c4
y.create.l HWIO_SNOC_EPRB0_SPROF_COUNTERS_7_ALARMMODE_ADDR A:0x605831c8
y.create.l HWIO_SNOC_EPRB0_SPROF_COUNTERS_7_VAL_ADDR A:0x605831cc
y.create.l HWIO_SNOC_EPRB0_SPROF_COUNTERS_8_PORTSEL_ADDR A:0x605831d4
y.create.l HWIO_SNOC_EPRB0_SPROF_COUNTERS_8_SRC_ADDR A:0x605831d8
y.create.l HWIO_SNOC_EPRB0_SPROF_COUNTERS_8_ALARMMODE_ADDR A:0x605831dc
y.create.l HWIO_SNOC_EPRB0_SPROF_COUNTERS_8_VAL_ADDR A:0x605831e0
y.create.l HWIO_SNOC_EPRB0_SPROF_COUNTERS_9_PORTSEL_ADDR A:0x605831e8
y.create.l HWIO_SNOC_EPRB0_SPROF_COUNTERS_9_SRC_ADDR A:0x605831ec
y.create.l HWIO_SNOC_EPRB0_SPROF_COUNTERS_9_ALARMMODE_ADDR A:0x605831f0
y.create.l HWIO_SNOC_EPRB0_SPROF_COUNTERS_9_VAL_ADDR A:0x605831f4
y.create.l HWIO_SNOC_EPRB1_SPROF_ID_COREID_ADDR A:0x60583400
y.create.l HWIO_SNOC_EPRB1_SPROF_ID_REVISIONID_ADDR A:0x60583404
y.create.l HWIO_SNOC_EPRB1_SPROF_MAINCTL_ADDR A:0x60583408
y.create.l HWIO_SNOC_EPRB1_SPROF_CFGCTL_ADDR A:0x6058340c
y.create.l HWIO_SNOC_EPRB1_SPROF_TRACEPORTSEL_ADDR A:0x60583410
y.create.l HWIO_SNOC_EPRB1_SPROF_FILTERLUT_ADDR A:0x60583414
y.create.l HWIO_SNOC_EPRB1_SPROF_TRACEALARMEN_ADDR A:0x60583418
y.create.l HWIO_SNOC_EPRB1_SPROF_TRACEALARMSTATUS_ADDR A:0x6058341c
y.create.l HWIO_SNOC_EPRB1_SPROF_TRACEALARMCLR_ADDR A:0x60583420
y.create.l HWIO_SNOC_EPRB1_SPROF_STATPERIOD_ADDR A:0x60583424
y.create.l HWIO_SNOC_EPRB1_SPROF_STATGO_ADDR A:0x60583428
y.create.l HWIO_SNOC_EPRB1_SPROF_STATALARMMIN_ADDR A:0x6058342c
y.create.l HWIO_SNOC_EPRB1_SPROF_STATALARMMAX_ADDR A:0x60583430
y.create.l HWIO_SNOC_EPRB1_SPROF_STATALARMSTATUS_ADDR A:0x60583434
y.create.l HWIO_SNOC_EPRB1_SPROF_STATALARMCLR_ADDR A:0x60583438
y.create.l HWIO_SNOC_EPRB1_SPROF_STATALARMEN_ADDR A:0x6058343c
y.create.l HWIO_SNOC_EPRB1_SPROF_FILTERS_0_ROUTEIDBASE_ADDR A:0x60583444
y.create.l HWIO_SNOC_EPRB1_SPROF_FILTERS_0_ROUTEIDMASK_ADDR A:0x60583448
y.create.l HWIO_SNOC_EPRB1_SPROF_FILTERS_0_ADDRBASE_LOW_ADDR A:0x6058344c
y.create.l HWIO_SNOC_EPRB1_SPROF_FILTERS_0_ADDRBASE_HIGH_ADDR A:0x60583450
y.create.l HWIO_SNOC_EPRB1_SPROF_FILTERS_0_WINDOWSIZE_ADDR A:0x60583454
y.create.l HWIO_SNOC_EPRB1_SPROF_FILTERS_0_OPCODE_ADDR A:0x60583460
y.create.l HWIO_SNOC_EPRB1_SPROF_FILTERS_0_STATUS_ADDR A:0x60583464
y.create.l HWIO_SNOC_EPRB1_SPROF_FILTERS_0_LENGTH_ADDR A:0x60583468
y.create.l HWIO_SNOC_EPRB1_SPROF_FILTERS_0_URGENCY_ADDR A:0x6058346c
y.create.l HWIO_SNOC_EPRB1_SPROF_FILTERS_1_ROUTEIDBASE_ADDR A:0x60583480
y.create.l HWIO_SNOC_EPRB1_SPROF_FILTERS_1_ROUTEIDMASK_ADDR A:0x60583484
y.create.l HWIO_SNOC_EPRB1_SPROF_FILTERS_1_ADDRBASE_LOW_ADDR A:0x60583488
y.create.l HWIO_SNOC_EPRB1_SPROF_FILTERS_1_ADDRBASE_HIGH_ADDR A:0x6058348c
y.create.l HWIO_SNOC_EPRB1_SPROF_FILTERS_1_WINDOWSIZE_ADDR A:0x60583490
y.create.l HWIO_SNOC_EPRB1_SPROF_FILTERS_1_OPCODE_ADDR A:0x6058349c
y.create.l HWIO_SNOC_EPRB1_SPROF_FILTERS_1_STATUS_ADDR A:0x605834a0
y.create.l HWIO_SNOC_EPRB1_SPROF_FILTERS_1_LENGTH_ADDR A:0x605834a4
y.create.l HWIO_SNOC_EPRB1_SPROF_FILTERS_1_URGENCY_ADDR A:0x605834a8
y.create.l HWIO_SNOC_EPRB1_SPROF_FILTERS_2_ROUTEIDBASE_ADDR A:0x605834bc
y.create.l HWIO_SNOC_EPRB1_SPROF_FILTERS_2_ROUTEIDMASK_ADDR A:0x605834c0
y.create.l HWIO_SNOC_EPRB1_SPROF_FILTERS_2_ADDRBASE_LOW_ADDR A:0x605834c4
y.create.l HWIO_SNOC_EPRB1_SPROF_FILTERS_2_ADDRBASE_HIGH_ADDR A:0x605834c8
y.create.l HWIO_SNOC_EPRB1_SPROF_FILTERS_2_WINDOWSIZE_ADDR A:0x605834cc
y.create.l HWIO_SNOC_EPRB1_SPROF_FILTERS_2_OPCODE_ADDR A:0x605834d8
y.create.l HWIO_SNOC_EPRB1_SPROF_FILTERS_2_STATUS_ADDR A:0x605834dc
y.create.l HWIO_SNOC_EPRB1_SPROF_FILTERS_2_LENGTH_ADDR A:0x605834e0
y.create.l HWIO_SNOC_EPRB1_SPROF_FILTERS_2_URGENCY_ADDR A:0x605834e4
y.create.l HWIO_SNOC_EPRB1_SPROF_FILTERS_3_ROUTEIDBASE_ADDR A:0x605834f8
y.create.l HWIO_SNOC_EPRB1_SPROF_FILTERS_3_ROUTEIDMASK_ADDR A:0x605834fc
y.create.l HWIO_SNOC_EPRB1_SPROF_FILTERS_3_ADDRBASE_LOW_ADDR A:0x60583500
y.create.l HWIO_SNOC_EPRB1_SPROF_FILTERS_3_ADDRBASE_HIGH_ADDR A:0x60583504
y.create.l HWIO_SNOC_EPRB1_SPROF_FILTERS_3_WINDOWSIZE_ADDR A:0x60583508
y.create.l HWIO_SNOC_EPRB1_SPROF_FILTERS_3_OPCODE_ADDR A:0x60583514
y.create.l HWIO_SNOC_EPRB1_SPROF_FILTERS_3_STATUS_ADDR A:0x60583518
y.create.l HWIO_SNOC_EPRB1_SPROF_FILTERS_3_LENGTH_ADDR A:0x6058351c
y.create.l HWIO_SNOC_EPRB1_SPROF_FILTERS_3_URGENCY_ADDR A:0x60583520
y.create.l HWIO_SNOC_EPRB1_SPROF_COUNTERS_0_PORTSEL_ADDR A:0x60583534
y.create.l HWIO_SNOC_EPRB1_SPROF_COUNTERS_0_SRC_ADDR A:0x60583538
y.create.l HWIO_SNOC_EPRB1_SPROF_COUNTERS_0_ALARMMODE_ADDR A:0x6058353c
y.create.l HWIO_SNOC_EPRB1_SPROF_COUNTERS_0_VAL_ADDR A:0x60583540
y.create.l HWIO_SNOC_EPRB1_SPROF_COUNTERS_1_PORTSEL_ADDR A:0x60583548
y.create.l HWIO_SNOC_EPRB1_SPROF_COUNTERS_1_SRC_ADDR A:0x6058354c
y.create.l HWIO_SNOC_EPRB1_SPROF_COUNTERS_1_ALARMMODE_ADDR A:0x60583550
y.create.l HWIO_SNOC_EPRB1_SPROF_COUNTERS_1_VAL_ADDR A:0x60583554
y.create.l HWIO_SNOC_EPRB1_SPROF_COUNTERS_2_PORTSEL_ADDR A:0x6058355c
y.create.l HWIO_SNOC_EPRB1_SPROF_COUNTERS_2_SRC_ADDR A:0x60583560
y.create.l HWIO_SNOC_EPRB1_SPROF_COUNTERS_2_ALARMMODE_ADDR A:0x60583564
y.create.l HWIO_SNOC_EPRB1_SPROF_COUNTERS_2_VAL_ADDR A:0x60583568
y.create.l HWIO_SNOC_EPRB1_SPROF_COUNTERS_3_PORTSEL_ADDR A:0x60583570
y.create.l HWIO_SNOC_EPRB1_SPROF_COUNTERS_3_SRC_ADDR A:0x60583574
y.create.l HWIO_SNOC_EPRB1_SPROF_COUNTERS_3_ALARMMODE_ADDR A:0x60583578
y.create.l HWIO_SNOC_EPRB1_SPROF_COUNTERS_3_VAL_ADDR A:0x6058357c
y.create.l HWIO_SNOC_EPRB1_SPROF_COUNTERS_4_PORTSEL_ADDR A:0x60583584
y.create.l HWIO_SNOC_EPRB1_SPROF_COUNTERS_4_SRC_ADDR A:0x60583588
y.create.l HWIO_SNOC_EPRB1_SPROF_COUNTERS_4_ALARMMODE_ADDR A:0x6058358c
y.create.l HWIO_SNOC_EPRB1_SPROF_COUNTERS_4_VAL_ADDR A:0x60583590
y.create.l HWIO_SNOC_EPRB1_SPROF_COUNTERS_5_PORTSEL_ADDR A:0x60583598
y.create.l HWIO_SNOC_EPRB1_SPROF_COUNTERS_5_SRC_ADDR A:0x6058359c
y.create.l HWIO_SNOC_EPRB1_SPROF_COUNTERS_5_ALARMMODE_ADDR A:0x605835a0
y.create.l HWIO_SNOC_EPRB1_SPROF_COUNTERS_5_VAL_ADDR A:0x605835a4
y.create.l HWIO_SNOC_EPRB1_SPROF_COUNTERS_6_PORTSEL_ADDR A:0x605835ac
y.create.l HWIO_SNOC_EPRB1_SPROF_COUNTERS_6_SRC_ADDR A:0x605835b0
y.create.l HWIO_SNOC_EPRB1_SPROF_COUNTERS_6_ALARMMODE_ADDR A:0x605835b4
y.create.l HWIO_SNOC_EPRB1_SPROF_COUNTERS_6_VAL_ADDR A:0x605835b8
y.create.l HWIO_SNOC_EPRB1_SPROF_COUNTERS_7_PORTSEL_ADDR A:0x605835c0
y.create.l HWIO_SNOC_EPRB1_SPROF_COUNTERS_7_SRC_ADDR A:0x605835c4
y.create.l HWIO_SNOC_EPRB1_SPROF_COUNTERS_7_ALARMMODE_ADDR A:0x605835c8
y.create.l HWIO_SNOC_EPRB1_SPROF_COUNTERS_7_VAL_ADDR A:0x605835cc
y.create.l HWIO_SNOC_EPRB1_SPROF_COUNTERS_8_PORTSEL_ADDR A:0x605835d4
y.create.l HWIO_SNOC_EPRB1_SPROF_COUNTERS_8_SRC_ADDR A:0x605835d8
y.create.l HWIO_SNOC_EPRB1_SPROF_COUNTERS_8_ALARMMODE_ADDR A:0x605835dc
y.create.l HWIO_SNOC_EPRB1_SPROF_COUNTERS_8_VAL_ADDR A:0x605835e0
y.create.l HWIO_SNOC_EPRB1_SPROF_COUNTERS_9_PORTSEL_ADDR A:0x605835e8
y.create.l HWIO_SNOC_EPRB1_SPROF_COUNTERS_9_SRC_ADDR A:0x605835ec
y.create.l HWIO_SNOC_EPRB1_SPROF_COUNTERS_9_ALARMMODE_ADDR A:0x605835f0
y.create.l HWIO_SNOC_EPRB1_SPROF_COUNTERS_9_VAL_ADDR A:0x605835f4
y.create.l HWIO_SNOC_TPRB0_SPROF_ID_COREID_ADDR A:0x60584000
y.create.l HWIO_SNOC_TPRB0_SPROF_ID_REVISIONID_ADDR A:0x60584004
y.create.l HWIO_SNOC_TPRB0_SPROF_MAINCTL_ADDR A:0x60584008
y.create.l HWIO_SNOC_TPRB0_SPROF_CFGCTL_ADDR A:0x6058400c
y.create.l HWIO_SNOC_TPRB0_SPROF_STATPERIOD_ADDR A:0x60584024
y.create.l HWIO_SNOC_TPRB0_SPROF_STATGO_ADDR A:0x60584028
y.create.l HWIO_SNOC_TPRB0_SPROF_STATALARMMIN_ADDR A:0x6058402c
y.create.l HWIO_SNOC_TPRB0_SPROF_STATALARMMAX_ADDR A:0x60584030
y.create.l HWIO_SNOC_TPRB0_SPROF_STATALARMSTATUS_ADDR A:0x60584034
y.create.l HWIO_SNOC_TPRB0_SPROF_STATALARMCLR_ADDR A:0x60584038
y.create.l HWIO_SNOC_TPRB0_SPROF_STATALARMEN_ADDR A:0x6058403c
y.create.l HWIO_SNOC_TPRB0_SPROF_COUNTERS_0_SRC_ADDR A:0x60584138
y.create.l HWIO_SNOC_TPRB0_SPROF_COUNTERS_0_ALARMMODE_ADDR A:0x6058413c
y.create.l HWIO_SNOC_TPRB0_SPROF_COUNTERS_0_VAL_ADDR A:0x60584140
y.create.l HWIO_SNOC_TPRB0_SPROF_COUNTERS_1_SRC_ADDR A:0x6058414c
y.create.l HWIO_SNOC_TPRB0_SPROF_COUNTERS_1_ALARMMODE_ADDR A:0x60584150
y.create.l HWIO_SNOC_TPRB0_SPROF_COUNTERS_1_VAL_ADDR A:0x60584154
y.create.l HWIO_SNOC_TPRB0_SPROF_COUNTERS_2_SRC_ADDR A:0x60584160
y.create.l HWIO_SNOC_TPRB0_SPROF_COUNTERS_2_ALARMMODE_ADDR A:0x60584164
y.create.l HWIO_SNOC_TPRB0_SPROF_COUNTERS_2_VAL_ADDR A:0x60584168
y.create.l HWIO_SNOC_TPRB0_SPROF_COUNTERS_3_SRC_ADDR A:0x60584174
y.create.l HWIO_SNOC_TPRB0_SPROF_COUNTERS_3_ALARMMODE_ADDR A:0x60584178
y.create.l HWIO_SNOC_TPRB0_SPROF_COUNTERS_3_VAL_ADDR A:0x6058417c
y.create.l HWIO_SNOC_TPRB0_SPROF_COUNTERS_4_SRC_ADDR A:0x60584188
y.create.l HWIO_SNOC_TPRB0_SPROF_COUNTERS_4_ALARMMODE_ADDR A:0x6058418c
y.create.l HWIO_SNOC_TPRB0_SPROF_COUNTERS_4_VAL_ADDR A:0x60584190
y.create.l HWIO_SNOC_TPRB0_SPROF_COUNTERS_5_SRC_ADDR A:0x6058419c
y.create.l HWIO_SNOC_TPRB0_SPROF_COUNTERS_5_ALARMMODE_ADDR A:0x605841a0
y.create.l HWIO_SNOC_TPRB0_SPROF_COUNTERS_5_VAL_ADDR A:0x605841a4
y.create.l HWIO_SNOC_TPRB0_SPROF_COUNTERS_6_SRC_ADDR A:0x605841b0
y.create.l HWIO_SNOC_TPRB0_SPROF_COUNTERS_6_ALARMMODE_ADDR A:0x605841b4
y.create.l HWIO_SNOC_TPRB0_SPROF_COUNTERS_6_VAL_ADDR A:0x605841b8
y.create.l HWIO_SNOC_TPRB0_SPROF_COUNTERS_7_SRC_ADDR A:0x605841c4
y.create.l HWIO_SNOC_TPRB0_SPROF_COUNTERS_7_ALARMMODE_ADDR A:0x605841c8
y.create.l HWIO_SNOC_TPRB0_SPROF_COUNTERS_7_VAL_ADDR A:0x605841cc
y.create.l HWIO_SNOC_TPRB0_SPROF_COUNTERS_8_SRC_ADDR A:0x605841d8
y.create.l HWIO_SNOC_TPRB0_SPROF_COUNTERS_8_ALARMMODE_ADDR A:0x605841dc
y.create.l HWIO_SNOC_TPRB0_SPROF_COUNTERS_8_VAL_ADDR A:0x605841e0
y.create.l HWIO_SNOC_TPRB0_SPROF_COUNTERS_9_SRC_ADDR A:0x605841ec
y.create.l HWIO_SNOC_TPRB0_SPROF_COUNTERS_9_ALARMMODE_ADDR A:0x605841f0
y.create.l HWIO_SNOC_TPRB0_SPROF_COUNTERS_9_VAL_ADDR A:0x605841f4
y.create.l HWIO_SNOC_TPRB0_SPROF_COUNTERS_10_SRC_ADDR A:0x60584200
y.create.l HWIO_SNOC_TPRB0_SPROF_COUNTERS_10_ALARMMODE_ADDR A:0x60584204
y.create.l HWIO_SNOC_TPRB0_SPROF_COUNTERS_10_VAL_ADDR A:0x60584208
y.create.l HWIO_SNOC_TPRB0_SPROF_COUNTERS_11_SRC_ADDR A:0x60584214
y.create.l HWIO_SNOC_TPRB0_SPROF_COUNTERS_11_ALARMMODE_ADDR A:0x60584218
y.create.l HWIO_SNOC_TPRB0_SPROF_COUNTERS_11_VAL_ADDR A:0x6058421c
y.create.l HWIO_SNOC_TPRB0_SPROF_COUNTERS_12_SRC_ADDR A:0x60584228
y.create.l HWIO_SNOC_TPRB0_SPROF_COUNTERS_12_ALARMMODE_ADDR A:0x6058422c
y.create.l HWIO_SNOC_TPRB0_SPROF_COUNTERS_12_VAL_ADDR A:0x60584230
y.create.l HWIO_SNOC_TPRB0_SPROF_COUNTERS_13_SRC_ADDR A:0x6058423c
y.create.l HWIO_SNOC_TPRB0_SPROF_COUNTERS_13_ALARMMODE_ADDR A:0x60584240
y.create.l HWIO_SNOC_TPRB0_SPROF_COUNTERS_13_VAL_ADDR A:0x60584244
y.create.l HWIO_SNOC_TPRB0_SPROF_COUNTERS_14_SRC_ADDR A:0x60584250
y.create.l HWIO_SNOC_TPRB0_SPROF_COUNTERS_14_ALARMMODE_ADDR A:0x60584254
y.create.l HWIO_SNOC_TPRB0_SPROF_COUNTERS_14_VAL_ADDR A:0x60584258
y.create.l HWIO_SNOC_TPRB0_SPROF_COUNTERS_15_SRC_ADDR A:0x60584264
y.create.l HWIO_SNOC_TPRB0_SPROF_COUNTERS_15_ALARMMODE_ADDR A:0x60584268
y.create.l HWIO_SNOC_TPRB0_SPROF_COUNTERS_15_VAL_ADDR A:0x6058426c
y.create.l HWIO_SNOC_TPRB1_SPROF_ID_COREID_ADDR A:0x60584400
y.create.l HWIO_SNOC_TPRB1_SPROF_ID_REVISIONID_ADDR A:0x60584404
y.create.l HWIO_SNOC_TPRB1_SPROF_MAINCTL_ADDR A:0x60584408
y.create.l HWIO_SNOC_TPRB1_SPROF_CFGCTL_ADDR A:0x6058440c
y.create.l HWIO_SNOC_TPRB1_SPROF_STATPERIOD_ADDR A:0x60584424
y.create.l HWIO_SNOC_TPRB1_SPROF_STATGO_ADDR A:0x60584428
y.create.l HWIO_SNOC_TPRB1_SPROF_STATALARMMIN_ADDR A:0x6058442c
y.create.l HWIO_SNOC_TPRB1_SPROF_STATALARMMAX_ADDR A:0x60584430
y.create.l HWIO_SNOC_TPRB1_SPROF_STATALARMSTATUS_ADDR A:0x60584434
y.create.l HWIO_SNOC_TPRB1_SPROF_STATALARMCLR_ADDR A:0x60584438
y.create.l HWIO_SNOC_TPRB1_SPROF_STATALARMEN_ADDR A:0x6058443c
y.create.l HWIO_SNOC_TPRB1_SPROF_COUNTERS_0_SRC_ADDR A:0x60584538
y.create.l HWIO_SNOC_TPRB1_SPROF_COUNTERS_0_ALARMMODE_ADDR A:0x6058453c
y.create.l HWIO_SNOC_TPRB1_SPROF_COUNTERS_0_VAL_ADDR A:0x60584540
y.create.l HWIO_SNOC_TPRB1_SPROF_COUNTERS_1_SRC_ADDR A:0x6058454c
y.create.l HWIO_SNOC_TPRB1_SPROF_COUNTERS_1_ALARMMODE_ADDR A:0x60584550
y.create.l HWIO_SNOC_TPRB1_SPROF_COUNTERS_1_VAL_ADDR A:0x60584554
y.create.l HWIO_SNOC_TPRB1_SPROF_COUNTERS_2_SRC_ADDR A:0x60584560
y.create.l HWIO_SNOC_TPRB1_SPROF_COUNTERS_2_ALARMMODE_ADDR A:0x60584564
y.create.l HWIO_SNOC_TPRB1_SPROF_COUNTERS_2_VAL_ADDR A:0x60584568
y.create.l HWIO_SNOC_TPRB1_SPROF_COUNTERS_3_SRC_ADDR A:0x60584574
y.create.l HWIO_SNOC_TPRB1_SPROF_COUNTERS_3_ALARMMODE_ADDR A:0x60584578
y.create.l HWIO_SNOC_TPRB1_SPROF_COUNTERS_3_VAL_ADDR A:0x6058457c
y.create.l HWIO_SNOC_TPRB1_SPROF_COUNTERS_4_SRC_ADDR A:0x60584588
y.create.l HWIO_SNOC_TPRB1_SPROF_COUNTERS_4_ALARMMODE_ADDR A:0x6058458c
y.create.l HWIO_SNOC_TPRB1_SPROF_COUNTERS_4_VAL_ADDR A:0x60584590
y.create.l HWIO_SNOC_TPRB1_SPROF_COUNTERS_5_SRC_ADDR A:0x6058459c
y.create.l HWIO_SNOC_TPRB1_SPROF_COUNTERS_5_ALARMMODE_ADDR A:0x605845a0
y.create.l HWIO_SNOC_TPRB1_SPROF_COUNTERS_5_VAL_ADDR A:0x605845a4
y.create.l HWIO_SNOC_TPRB1_SPROF_COUNTERS_6_SRC_ADDR A:0x605845b0
y.create.l HWIO_SNOC_TPRB1_SPROF_COUNTERS_6_ALARMMODE_ADDR A:0x605845b4
y.create.l HWIO_SNOC_TPRB1_SPROF_COUNTERS_6_VAL_ADDR A:0x605845b8
y.create.l HWIO_SNOC_TPRB1_SPROF_COUNTERS_7_SRC_ADDR A:0x605845c4
y.create.l HWIO_SNOC_TPRB1_SPROF_COUNTERS_7_ALARMMODE_ADDR A:0x605845c8
y.create.l HWIO_SNOC_TPRB1_SPROF_COUNTERS_7_VAL_ADDR A:0x605845cc
y.create.l HWIO_SNOC_TPRB1_SPROF_COUNTERS_8_SRC_ADDR A:0x605845d8
y.create.l HWIO_SNOC_TPRB1_SPROF_COUNTERS_8_ALARMMODE_ADDR A:0x605845dc
y.create.l HWIO_SNOC_TPRB1_SPROF_COUNTERS_8_VAL_ADDR A:0x605845e0
y.create.l HWIO_SNOC_TPRB1_SPROF_COUNTERS_9_SRC_ADDR A:0x605845ec
y.create.l HWIO_SNOC_TPRB1_SPROF_COUNTERS_9_ALARMMODE_ADDR A:0x605845f0
y.create.l HWIO_SNOC_TPRB1_SPROF_COUNTERS_9_VAL_ADDR A:0x605845f4
y.create.l HWIO_SNOC_TPRB1_SPROF_COUNTERS_10_SRC_ADDR A:0x60584600
y.create.l HWIO_SNOC_TPRB1_SPROF_COUNTERS_10_ALARMMODE_ADDR A:0x60584604
y.create.l HWIO_SNOC_TPRB1_SPROF_COUNTERS_10_VAL_ADDR A:0x60584608
y.create.l HWIO_SNOC_TPRB1_SPROF_COUNTERS_11_SRC_ADDR A:0x60584614
y.create.l HWIO_SNOC_TPRB1_SPROF_COUNTERS_11_ALARMMODE_ADDR A:0x60584618
y.create.l HWIO_SNOC_TPRB1_SPROF_COUNTERS_11_VAL_ADDR A:0x6058461c
y.create.l HWIO_SNOC_TPRB1_SPROF_COUNTERS_12_SRC_ADDR A:0x60584628
y.create.l HWIO_SNOC_TPRB1_SPROF_COUNTERS_12_ALARMMODE_ADDR A:0x6058462c
y.create.l HWIO_SNOC_TPRB1_SPROF_COUNTERS_12_VAL_ADDR A:0x60584630
y.create.l HWIO_SNOC_TPRB1_SPROF_COUNTERS_13_SRC_ADDR A:0x6058463c
y.create.l HWIO_SNOC_TPRB1_SPROF_COUNTERS_13_ALARMMODE_ADDR A:0x60584640
y.create.l HWIO_SNOC_TPRB1_SPROF_COUNTERS_13_VAL_ADDR A:0x60584644
y.create.l HWIO_SNOC_TPRB1_SPROF_COUNTERS_14_SRC_ADDR A:0x60584650
y.create.l HWIO_SNOC_TPRB1_SPROF_COUNTERS_14_ALARMMODE_ADDR A:0x60584654
y.create.l HWIO_SNOC_TPRB1_SPROF_COUNTERS_14_VAL_ADDR A:0x60584658
y.create.l HWIO_SNOC_TPRB1_SPROF_COUNTERS_15_SRC_ADDR A:0x60584664
y.create.l HWIO_SNOC_TPRB1_SPROF_COUNTERS_15_ALARMMODE_ADDR A:0x60584668
y.create.l HWIO_SNOC_TPRB1_SPROF_COUNTERS_15_VAL_ADDR A:0x6058466c
y.create.l HWIO_SNOC_TPRB2_SPROF_ID_COREID_ADDR A:0x60584800
y.create.l HWIO_SNOC_TPRB2_SPROF_ID_REVISIONID_ADDR A:0x60584804
y.create.l HWIO_SNOC_TPRB2_SPROF_MAINCTL_ADDR A:0x60584808
y.create.l HWIO_SNOC_TPRB2_SPROF_CFGCTL_ADDR A:0x6058480c
y.create.l HWIO_SNOC_TPRB2_SPROF_STATPERIOD_ADDR A:0x60584824
y.create.l HWIO_SNOC_TPRB2_SPROF_STATGO_ADDR A:0x60584828
y.create.l HWIO_SNOC_TPRB2_SPROF_STATALARMMIN_ADDR A:0x6058482c
y.create.l HWIO_SNOC_TPRB2_SPROF_STATALARMMAX_ADDR A:0x60584830
y.create.l HWIO_SNOC_TPRB2_SPROF_STATALARMSTATUS_ADDR A:0x60584834
y.create.l HWIO_SNOC_TPRB2_SPROF_STATALARMCLR_ADDR A:0x60584838
y.create.l HWIO_SNOC_TPRB2_SPROF_STATALARMEN_ADDR A:0x6058483c
y.create.l HWIO_SNOC_TPRB2_SPROF_COUNTERS_0_SRC_ADDR A:0x60584938
y.create.l HWIO_SNOC_TPRB2_SPROF_COUNTERS_0_ALARMMODE_ADDR A:0x6058493c
y.create.l HWIO_SNOC_TPRB2_SPROF_COUNTERS_0_VAL_ADDR A:0x60584940
y.create.l HWIO_SNOC_TPRB2_SPROF_COUNTERS_1_SRC_ADDR A:0x6058494c
y.create.l HWIO_SNOC_TPRB2_SPROF_COUNTERS_1_ALARMMODE_ADDR A:0x60584950
y.create.l HWIO_SNOC_TPRB2_SPROF_COUNTERS_1_VAL_ADDR A:0x60584954
y.create.l HWIO_SNOC_TPRB2_SPROF_COUNTERS_2_SRC_ADDR A:0x60584960
y.create.l HWIO_SNOC_TPRB2_SPROF_COUNTERS_2_ALARMMODE_ADDR A:0x60584964
y.create.l HWIO_SNOC_TPRB2_SPROF_COUNTERS_2_VAL_ADDR A:0x60584968
y.create.l HWIO_SNOC_TPRB2_SPROF_COUNTERS_3_SRC_ADDR A:0x60584974
y.create.l HWIO_SNOC_TPRB2_SPROF_COUNTERS_3_ALARMMODE_ADDR A:0x60584978
y.create.l HWIO_SNOC_TPRB2_SPROF_COUNTERS_3_VAL_ADDR A:0x6058497c
y.create.l HWIO_SNOC_TPRB2_SPROF_COUNTERS_4_SRC_ADDR A:0x60584988
y.create.l HWIO_SNOC_TPRB2_SPROF_COUNTERS_4_ALARMMODE_ADDR A:0x6058498c
y.create.l HWIO_SNOC_TPRB2_SPROF_COUNTERS_4_VAL_ADDR A:0x60584990
y.create.l HWIO_SNOC_TPRB2_SPROF_COUNTERS_5_SRC_ADDR A:0x6058499c
y.create.l HWIO_SNOC_TPRB2_SPROF_COUNTERS_5_ALARMMODE_ADDR A:0x605849a0
y.create.l HWIO_SNOC_TPRB2_SPROF_COUNTERS_5_VAL_ADDR A:0x605849a4
y.create.l HWIO_SNOC_TPRB2_SPROF_COUNTERS_6_SRC_ADDR A:0x605849b0
y.create.l HWIO_SNOC_TPRB2_SPROF_COUNTERS_6_ALARMMODE_ADDR A:0x605849b4
y.create.l HWIO_SNOC_TPRB2_SPROF_COUNTERS_6_VAL_ADDR A:0x605849b8
y.create.l HWIO_SNOC_TPRB2_SPROF_COUNTERS_7_SRC_ADDR A:0x605849c4
y.create.l HWIO_SNOC_TPRB2_SPROF_COUNTERS_7_ALARMMODE_ADDR A:0x605849c8
y.create.l HWIO_SNOC_TPRB2_SPROF_COUNTERS_7_VAL_ADDR A:0x605849cc
y.create.l HWIO_SNOC_TPRB2_SPROF_COUNTERS_8_SRC_ADDR A:0x605849d8
y.create.l HWIO_SNOC_TPRB2_SPROF_COUNTERS_8_ALARMMODE_ADDR A:0x605849dc
y.create.l HWIO_SNOC_TPRB2_SPROF_COUNTERS_8_VAL_ADDR A:0x605849e0
y.create.l HWIO_SNOC_TPRB2_SPROF_COUNTERS_9_SRC_ADDR A:0x605849ec
y.create.l HWIO_SNOC_TPRB2_SPROF_COUNTERS_9_ALARMMODE_ADDR A:0x605849f0
y.create.l HWIO_SNOC_TPRB2_SPROF_COUNTERS_9_VAL_ADDR A:0x605849f4
y.create.l HWIO_SNOC_TPRB2_SPROF_COUNTERS_10_SRC_ADDR A:0x60584a00
y.create.l HWIO_SNOC_TPRB2_SPROF_COUNTERS_10_ALARMMODE_ADDR A:0x60584a04
y.create.l HWIO_SNOC_TPRB2_SPROF_COUNTERS_10_VAL_ADDR A:0x60584a08
y.create.l HWIO_SNOC_TPRB2_SPROF_COUNTERS_11_SRC_ADDR A:0x60584a14
y.create.l HWIO_SNOC_TPRB2_SPROF_COUNTERS_11_ALARMMODE_ADDR A:0x60584a18
y.create.l HWIO_SNOC_TPRB2_SPROF_COUNTERS_11_VAL_ADDR A:0x60584a1c
y.create.l HWIO_SNOC_TPRB2_SPROF_COUNTERS_12_SRC_ADDR A:0x60584a28
y.create.l HWIO_SNOC_TPRB2_SPROF_COUNTERS_12_ALARMMODE_ADDR A:0x60584a2c
y.create.l HWIO_SNOC_TPRB2_SPROF_COUNTERS_12_VAL_ADDR A:0x60584a30
y.create.l HWIO_SNOC_TPRB2_SPROF_COUNTERS_13_SRC_ADDR A:0x60584a3c
y.create.l HWIO_SNOC_TPRB2_SPROF_COUNTERS_13_ALARMMODE_ADDR A:0x60584a40
y.create.l HWIO_SNOC_TPRB2_SPROF_COUNTERS_13_VAL_ADDR A:0x60584a44
y.create.l HWIO_SNOC_TPRB2_SPROF_COUNTERS_14_SRC_ADDR A:0x60584a50
y.create.l HWIO_SNOC_TPRB2_SPROF_COUNTERS_14_ALARMMODE_ADDR A:0x60584a54
y.create.l HWIO_SNOC_TPRB2_SPROF_COUNTERS_14_VAL_ADDR A:0x60584a58
y.create.l HWIO_SNOC_TPRB2_SPROF_COUNTERS_15_SRC_ADDR A:0x60584a64
y.create.l HWIO_SNOC_TPRB2_SPROF_COUNTERS_15_ALARMMODE_ADDR A:0x60584a68
y.create.l HWIO_SNOC_TPRB2_SPROF_COUNTERS_15_VAL_ADDR A:0x60584a6c
y.create.l HWIO_SNOC_MSS_QOS_ID_COREID_ADDR A:0x60587000
y.create.l HWIO_SNOC_MSS_QOS_ID_REVISIONID_ADDR A:0x60587004
y.create.l HWIO_SNOC_MSS_QOS_PRIORITY_ADDR A:0x60587008
y.create.l HWIO_SNOC_MSS_QOS_MODE_ADDR A:0x6058700c
y.create.l HWIO_SNOC_MSS_QOS_BANDWIDTH_ADDR A:0x60587010
y.create.l HWIO_SNOC_MSS_QOS_SATURATION_ADDR A:0x60587014
y.create.l HWIO_SNOC_MSS_QOS_EXTCONTROL_ADDR A:0x60587018
y.create.l HWIO_SNOC_MSS_NAV_QOS_ID_COREID_ADDR A:0x60588000
y.create.l HWIO_SNOC_MSS_NAV_QOS_ID_REVISIONID_ADDR A:0x60588004
y.create.l HWIO_SNOC_MSS_NAV_QOS_PRIORITY_ADDR A:0x60588008
y.create.l HWIO_SNOC_MSS_NAV_QOS_MODE_ADDR A:0x6058800c
y.create.l HWIO_SNOC_MSS_NAV_QOS_EXTCONTROL_ADDR A:0x60588018
y.create.l HWIO_SNOC_WCSS_QOS_ID_COREID_ADDR A:0x6058b000
y.create.l HWIO_SNOC_WCSS_QOS_ID_REVISIONID_ADDR A:0x6058b004
y.create.l HWIO_SNOC_WCSS_QOS_PRIORITY_ADDR A:0x6058b008
y.create.l HWIO_SNOC_WCSS_QOS_MODE_ADDR A:0x6058b00c
y.create.l HWIO_SNOC_WCSS_QOS_EXTCONTROL_ADDR A:0x6058b018
y.create.l HWIO_SNOC_PCNOC_QOS_ID_COREID_ADDR A:0x6058c000
y.create.l HWIO_SNOC_PCNOC_QOS_ID_REVISIONID_ADDR A:0x6058c004
y.create.l HWIO_SNOC_PCNOC_QOS_PRIORITY_ADDR A:0x6058c008
y.create.l HWIO_SNOC_PCNOC_QOS_MODE_ADDR A:0x6058c00c
y.create.l HWIO_SNOC_PCNOC_QOS_BANDWIDTH_ADDR A:0x6058c010
y.create.l HWIO_SNOC_PCNOC_QOS_SATURATION_ADDR A:0x6058c014
y.create.l HWIO_SNOC_PCNOC_QOS_EXTCONTROL_ADDR A:0x6058c018
y.create.l HWIO_SNOC_MDP0_QOS_ID_COREID_ADDR A:0x6058e000
y.create.l HWIO_SNOC_MDP0_QOS_ID_REVISIONID_ADDR A:0x6058e004
y.create.l HWIO_SNOC_MDP0_QOS_PRIORITY_ADDR A:0x6058e008
y.create.l HWIO_SNOC_MDP0_QOS_MODE_ADDR A:0x6058e00c
y.create.l HWIO_SNOC_MDP0_QOS_EXTCONTROL_ADDR A:0x6058e018
y.create.l HWIO_SNOC_VENUS0_QOS_ID_COREID_ADDR A:0x6058f000
y.create.l HWIO_SNOC_VENUS0_QOS_ID_REVISIONID_ADDR A:0x6058f004
y.create.l HWIO_SNOC_VENUS0_QOS_PRIORITY_ADDR A:0x6058f008
y.create.l HWIO_SNOC_VENUS0_QOS_MODE_ADDR A:0x6058f00c
y.create.l HWIO_SNOC_VENUS0_QOS_BANDWIDTH_ADDR A:0x6058f010
y.create.l HWIO_SNOC_VENUS0_QOS_SATURATION_ADDR A:0x6058f014
y.create.l HWIO_SNOC_VENUS0_QOS_EXTCONTROL_ADDR A:0x6058f018
y.create.l HWIO_SNOC_VFE_QOS_ID_COREID_ADDR A:0x60590000
y.create.l HWIO_SNOC_VFE_QOS_ID_REVISIONID_ADDR A:0x60590004
y.create.l HWIO_SNOC_VFE_QOS_PRIORITY_ADDR A:0x60590008
y.create.l HWIO_SNOC_VFE_QOS_MODE_ADDR A:0x6059000c
y.create.l HWIO_SNOC_VFE_QOS_EXTCONTROL_ADDR A:0x60590018
y.create.l HWIO_SNOC_QDSS_ETR_QOS_ID_COREID_ADDR A:0x60591000
y.create.l HWIO_SNOC_QDSS_ETR_QOS_ID_REVISIONID_ADDR A:0x60591004
y.create.l HWIO_SNOC_QDSS_ETR_QOS_PRIORITY_ADDR A:0x60591008
y.create.l HWIO_SNOC_QDSS_ETR_QOS_MODE_ADDR A:0x6059100c
y.create.l HWIO_SNOC_QDSS_ETR_QOS_EXTCONTROL_ADDR A:0x60591018
y.create.l HWIO_SNOC_QDSS_BAM_QOS_ID_COREID_ADDR A:0x60592000
y.create.l HWIO_SNOC_QDSS_BAM_QOS_ID_REVISIONID_ADDR A:0x60592004
y.create.l HWIO_SNOC_QDSS_BAM_QOS_PRIORITY_ADDR A:0x60592008
y.create.l HWIO_SNOC_QDSS_BAM_QOS_MODE_ADDR A:0x6059200c
y.create.l HWIO_SNOC_QDSS_BAM_QOS_EXTCONTROL_ADDR A:0x60592018
y.create.l HWIO_TLMM_XPU_SCR_ADDR A:0x61300000
y.create.l HWIO_TLMM_XPU_SWDR_ADDR A:0x61300004
y.create.l HWIO_TLMM_XPU_PRTN_RACR_SSHADOW_ADDR A:0x61300008
y.create.l HWIO_TLMM_XPU_PRTN_WACR_SSHADOW_ADDR A:0x6130000c
y.create.l HWIO_TLMM_XPU_PRTN_START_SSHADOW0_ADDR A:0x61300010
y.create.l HWIO_TLMM_XPU_PRTN_END_SSHADOW0_ADDR A:0x61300018
y.create.l HWIO_TLMM_XPU_SEAR0_ADDR A:0x61300040
y.create.l HWIO_TLMM_XPU_SESR_ADDR A:0x61300048
y.create.l HWIO_TLMM_XPU_SESRRESTORE_ADDR A:0x6130004c
y.create.l HWIO_TLMM_XPU_SESYNR0_ADDR A:0x61300050
y.create.l HWIO_TLMM_XPU_SESYNR1_ADDR A:0x61300054
y.create.l HWIO_TLMM_XPU_SESYNR2_ADDR A:0x61300058
y.create.l HWIO_TLMM_XPU_MCR_ADDR A:0x61300100
y.create.l HWIO_TLMM_XPU_MEAR0_ADDR A:0x61300140
y.create.l HWIO_TLMM_XPU_MESR_ADDR A:0x61300148
y.create.l HWIO_TLMM_XPU_MESRRESTORE_ADDR A:0x6130014c
y.create.l HWIO_TLMM_XPU_MESYNR0_ADDR A:0x61300150
y.create.l HWIO_TLMM_XPU_MESYNR1_ADDR A:0x61300154
y.create.l HWIO_TLMM_XPU_MESYNR2_ADDR A:0x61300158
y.create.l HWIO_TLMM_XPU_CR_ADDR A:0x61300080
y.create.l HWIO_TLMM_XPU_PRTN_RACR_SHADOW_ADDR A:0x61300088
y.create.l HWIO_TLMM_XPU_PRTN_WACR_SHADOW_ADDR A:0x6130008c
y.create.l HWIO_TLMM_XPU_PRTN_START_SHADOW0_ADDR A:0x61300090
y.create.l HWIO_TLMM_XPU_PRTN_END_SHADOW0_ADDR A:0x61300098
y.create.l HWIO_TLMM_XPU_RPU_ACR0_ADDR A:0x613000a0
y.create.l HWIO_TLMM_XPU_EAR0_ADDR A:0x613000c0
y.create.l HWIO_TLMM_XPU_ESR_ADDR A:0x613000c8
y.create.l HWIO_TLMM_XPU_ESRRESTORE_ADDR A:0x613000cc
y.create.l HWIO_TLMM_XPU_ESYNR0_ADDR A:0x613000d0
y.create.l HWIO_TLMM_XPU_ESYNR1_ADDR A:0x613000d4
y.create.l HWIO_TLMM_XPU_ESYNR2_ADDR A:0x613000d8
y.create.l HWIO_TLMM_XPU_UMR_RACR_ADDR A:0x613000e0
y.create.l HWIO_TLMM_XPU_UMR_WACR_ADDR A:0x613000e4
y.create.l HWIO_TLMM_XPU_UMR_CNTL_ADDR A:0x613000f0
y.create.l HWIO_TLMM_XPU_IDR0_ADDR A:0x61300074
y.create.l HWIO_TLMM_XPU_IDR1_ADDR A:0x61300078
y.create.l HWIO_TLMM_XPU_REV_ADDR A:0x6130007c
y.create.l HWIO_TLMM_XPU_PRT0_RACR0_ADDR A:0x61300200
y.create.l HWIO_TLMM_XPU_PRT1_RACR0_ADDR A:0x61300280
y.create.l HWIO_TLMM_XPU_PRT2_RACR0_ADDR A:0x61300300
y.create.l HWIO_TLMM_XPU_PRT3_RACR0_ADDR A:0x61300380
y.create.l HWIO_TLMM_XPU_PRT4_RACR0_ADDR A:0x61300400
y.create.l HWIO_TLMM_XPU_PRT5_RACR0_ADDR A:0x61300480
y.create.l HWIO_TLMM_XPU_PRT6_RACR0_ADDR A:0x61300500
y.create.l HWIO_TLMM_XPU_PRT7_RACR0_ADDR A:0x61300580
y.create.l HWIO_TLMM_XPU_PRT8_RACR0_ADDR A:0x61300600
y.create.l HWIO_TLMM_XPU_PRT9_RACR0_ADDR A:0x61300680
y.create.l HWIO_TLMM_XPU_PRT0_WACR0_ADDR A:0x61300220
y.create.l HWIO_TLMM_XPU_PRT1_WACR0_ADDR A:0x613002a0
y.create.l HWIO_TLMM_XPU_PRT2_WACR0_ADDR A:0x61300320
y.create.l HWIO_TLMM_XPU_PRT3_WACR0_ADDR A:0x613003a0
y.create.l HWIO_TLMM_XPU_PRT4_WACR0_ADDR A:0x61300420
y.create.l HWIO_TLMM_XPU_PRT5_WACR0_ADDR A:0x613004a0
y.create.l HWIO_TLMM_XPU_PRT6_WACR0_ADDR A:0x61300520
y.create.l HWIO_TLMM_XPU_PRT7_WACR0_ADDR A:0x613005a0
y.create.l HWIO_TLMM_XPU_PRT8_WACR0_ADDR A:0x61300620
y.create.l HWIO_TLMM_XPU_PRT9_WACR0_ADDR A:0x613006a0
y.create.l HWIO_TLMM_XPU_PRT0_START0_ADDR A:0x61300240
y.create.l HWIO_TLMM_XPU_PRT1_START0_ADDR A:0x613002c0
y.create.l HWIO_TLMM_XPU_PRT2_START0_ADDR A:0x61300340
y.create.l HWIO_TLMM_XPU_PRT3_START0_ADDR A:0x613003c0
y.create.l HWIO_TLMM_XPU_PRT4_START0_ADDR A:0x61300440
y.create.l HWIO_TLMM_XPU_PRT5_START0_ADDR A:0x613004c0
y.create.l HWIO_TLMM_XPU_PRT6_START0_ADDR A:0x61300540
y.create.l HWIO_TLMM_XPU_PRT7_START0_ADDR A:0x613005c0
y.create.l HWIO_TLMM_XPU_PRT8_START0_ADDR A:0x61300640
y.create.l HWIO_TLMM_XPU_PRT9_START0_ADDR A:0x613006c0
y.create.l HWIO_TLMM_XPU_PRT0_END0_ADDR A:0x61300248
y.create.l HWIO_TLMM_XPU_PRT1_END0_ADDR A:0x613002c8
y.create.l HWIO_TLMM_XPU_PRT2_END0_ADDR A:0x61300348
y.create.l HWIO_TLMM_XPU_PRT3_END0_ADDR A:0x613003c8
y.create.l HWIO_TLMM_XPU_PRT4_END0_ADDR A:0x61300448
y.create.l HWIO_TLMM_XPU_PRT5_END0_ADDR A:0x613004c8
y.create.l HWIO_TLMM_XPU_PRT6_END0_ADDR A:0x61300548
y.create.l HWIO_TLMM_XPU_PRT7_END0_ADDR A:0x613005c8
y.create.l HWIO_TLMM_XPU_PRT8_END0_ADDR A:0x61300648
y.create.l HWIO_TLMM_XPU_PRT9_END0_ADDR A:0x613006c8
y.create.l HWIO_TLMM_XPU_PRT0_SCR_ADDR A:0x61300250
y.create.l HWIO_TLMM_XPU_PRT1_SCR_ADDR A:0x613002d0
y.create.l HWIO_TLMM_XPU_PRT2_SCR_ADDR A:0x61300350
y.create.l HWIO_TLMM_XPU_PRT3_SCR_ADDR A:0x613003d0
y.create.l HWIO_TLMM_XPU_PRT4_SCR_ADDR A:0x61300450
y.create.l HWIO_TLMM_XPU_PRT5_SCR_ADDR A:0x613004d0
y.create.l HWIO_TLMM_XPU_PRT6_SCR_ADDR A:0x61300550
y.create.l HWIO_TLMM_XPU_PRT7_SCR_ADDR A:0x613005d0
y.create.l HWIO_TLMM_XPU_PRT8_SCR_ADDR A:0x61300650
y.create.l HWIO_TLMM_XPU_PRT9_SCR_ADDR A:0x613006d0
y.create.l HWIO_TLMM_XPU_PRT0_MCR_ADDR A:0x61300254
y.create.l HWIO_TLMM_XPU_PRT1_MCR_ADDR A:0x613002d4
y.create.l HWIO_TLMM_XPU_PRT2_MCR_ADDR A:0x61300354
y.create.l HWIO_TLMM_XPU_PRT3_MCR_ADDR A:0x613003d4
y.create.l HWIO_TLMM_XPU_PRT4_MCR_ADDR A:0x61300454
y.create.l HWIO_TLMM_XPU_PRT5_MCR_ADDR A:0x613004d4
y.create.l HWIO_TLMM_XPU_PRT6_MCR_ADDR A:0x61300554
y.create.l HWIO_TLMM_XPU_PRT7_MCR_ADDR A:0x613005d4
y.create.l HWIO_TLMM_XPU_PRT8_MCR_ADDR A:0x61300654
y.create.l HWIO_TLMM_XPU_PRT9_MCR_ADDR A:0x613006d4
y.create.l HWIO_TLMM_XPU_PRT0_CNTL0_ADDR A:0x61300258
y.create.l HWIO_TLMM_XPU_PRT1_CNTL0_ADDR A:0x613002d8
y.create.l HWIO_TLMM_XPU_PRT2_CNTL0_ADDR A:0x61300358
y.create.l HWIO_TLMM_XPU_PRT3_CNTL0_ADDR A:0x613003d8
y.create.l HWIO_TLMM_XPU_PRT4_CNTL0_ADDR A:0x61300458
y.create.l HWIO_TLMM_XPU_PRT5_CNTL0_ADDR A:0x613004d8
y.create.l HWIO_TLMM_XPU_PRT6_CNTL0_ADDR A:0x61300558
y.create.l HWIO_TLMM_XPU_PRT7_CNTL0_ADDR A:0x613005d8
y.create.l HWIO_TLMM_XPU_PRT8_CNTL0_ADDR A:0x61300658
y.create.l HWIO_TLMM_XPU_PRT9_CNTL0_ADDR A:0x613006d8
y.create.l HWIO_TLMM_XPU_PRT0_CNTL1_ADDR A:0x6130025c
y.create.l HWIO_TLMM_XPU_PRT1_CNTL1_ADDR A:0x613002dc
y.create.l HWIO_TLMM_XPU_PRT2_CNTL1_ADDR A:0x6130035c
y.create.l HWIO_TLMM_XPU_PRT3_CNTL1_ADDR A:0x613003dc
y.create.l HWIO_TLMM_XPU_PRT4_CNTL1_ADDR A:0x6130045c
y.create.l HWIO_TLMM_XPU_PRT5_CNTL1_ADDR A:0x613004dc
y.create.l HWIO_TLMM_XPU_PRT6_CNTL1_ADDR A:0x6130055c
y.create.l HWIO_TLMM_XPU_PRT7_CNTL1_ADDR A:0x613005dc
y.create.l HWIO_TLMM_XPU_PRT8_CNTL1_ADDR A:0x6130065c
y.create.l HWIO_TLMM_XPU_PRT9_CNTL1_ADDR A:0x613006dc
y.create.l HWIO_TLMM_GPIO_CFG0_ADDR A:0x61000000
y.create.l HWIO_TLMM_GPIO_CFG1_ADDR A:0x61001000
y.create.l HWIO_TLMM_GPIO_CFG2_ADDR A:0x61002000
y.create.l HWIO_TLMM_GPIO_CFG3_ADDR A:0x61003000
y.create.l HWIO_TLMM_GPIO_CFG4_ADDR A:0x61004000
y.create.l HWIO_TLMM_GPIO_CFG5_ADDR A:0x61005000
y.create.l HWIO_TLMM_GPIO_CFG6_ADDR A:0x61006000
y.create.l HWIO_TLMM_GPIO_CFG7_ADDR A:0x61007000
y.create.l HWIO_TLMM_GPIO_CFG8_ADDR A:0x61008000
y.create.l HWIO_TLMM_GPIO_CFG9_ADDR A:0x61009000
y.create.l HWIO_TLMM_GPIO_IN_OUT0_ADDR A:0x61000004
y.create.l HWIO_TLMM_GPIO_IN_OUT1_ADDR A:0x61001004
y.create.l HWIO_TLMM_GPIO_IN_OUT2_ADDR A:0x61002004
y.create.l HWIO_TLMM_GPIO_IN_OUT3_ADDR A:0x61003004
y.create.l HWIO_TLMM_GPIO_IN_OUT4_ADDR A:0x61004004
y.create.l HWIO_TLMM_GPIO_IN_OUT5_ADDR A:0x61005004
y.create.l HWIO_TLMM_GPIO_IN_OUT6_ADDR A:0x61006004
y.create.l HWIO_TLMM_GPIO_IN_OUT7_ADDR A:0x61007004
y.create.l HWIO_TLMM_GPIO_IN_OUT8_ADDR A:0x61008004
y.create.l HWIO_TLMM_GPIO_IN_OUT9_ADDR A:0x61009004
y.create.l HWIO_TLMM_GPIO_INTR_CFG0_ADDR A:0x61000008
y.create.l HWIO_TLMM_GPIO_INTR_CFG1_ADDR A:0x61001008
y.create.l HWIO_TLMM_GPIO_INTR_CFG2_ADDR A:0x61002008
y.create.l HWIO_TLMM_GPIO_INTR_CFG3_ADDR A:0x61003008
y.create.l HWIO_TLMM_GPIO_INTR_CFG4_ADDR A:0x61004008
y.create.l HWIO_TLMM_GPIO_INTR_CFG5_ADDR A:0x61005008
y.create.l HWIO_TLMM_GPIO_INTR_CFG6_ADDR A:0x61006008
y.create.l HWIO_TLMM_GPIO_INTR_CFG7_ADDR A:0x61007008
y.create.l HWIO_TLMM_GPIO_INTR_CFG8_ADDR A:0x61008008
y.create.l HWIO_TLMM_GPIO_INTR_CFG9_ADDR A:0x61009008
y.create.l HWIO_TLMM_GPIO_INTR_STATUS0_ADDR A:0x6100000c
y.create.l HWIO_TLMM_GPIO_INTR_STATUS1_ADDR A:0x6100100c
y.create.l HWIO_TLMM_GPIO_INTR_STATUS2_ADDR A:0x6100200c
y.create.l HWIO_TLMM_GPIO_INTR_STATUS3_ADDR A:0x6100300c
y.create.l HWIO_TLMM_GPIO_INTR_STATUS4_ADDR A:0x6100400c
y.create.l HWIO_TLMM_GPIO_INTR_STATUS5_ADDR A:0x6100500c
y.create.l HWIO_TLMM_GPIO_INTR_STATUS6_ADDR A:0x6100600c
y.create.l HWIO_TLMM_GPIO_INTR_STATUS7_ADDR A:0x6100700c
y.create.l HWIO_TLMM_GPIO_INTR_STATUS8_ADDR A:0x6100800c
y.create.l HWIO_TLMM_GPIO_INTR_STATUS9_ADDR A:0x6100900c
y.create.l HWIO_TLMM_CLK_GATE_EN_ADDR A:0x61100000
y.create.l HWIO_TLMM_IE_CTRL_DISABLE_ADDR A:0x61100004
y.create.l HWIO_TLMM_MPM_WAKEUP_INT_EN_0_ADDR A:0x61100008
y.create.l HWIO_TLMM_MPM_WAKEUP_INT_EN_1_ADDR A:0x6110000c
y.create.l HWIO_TLMM_INT_JTAG_CTL_ADDR A:0x61110000
y.create.l HWIO_TLMM_ETM_MODE_ADDR A:0x61110004
y.create.l HWIO_TLMM_DBG_BUS_OUT_SEL_ADDR A:0x61110008
y.create.l HWIO_TLMM_CHIP_MODE_ADDR A:0x6111000c
y.create.l HWIO_TLMM_SPARE_ADDR A:0x6110e000
y.create.l HWIO_SPARE1_ADDR A:0x6111001c
y.create.l HWIO_SPARE2_ADDR A:0x61110020
y.create.l HWIO_TLMM_HW_REVISION_NUMBER_ADDR A:0x61110010
y.create.l HWIO_TLMM_PERIPH_CHAR_TEST_MODE_ADDR A:0x61110014
y.create.l HWIO_TLMM_EBI2_EMMC_GPIO_CFG_ADDR A:0x61111000
y.create.l HWIO_TLMM_PBL_DEBUG_ADDR A:0x61110018
y.create.l HWIO_TLMM_RFFE_CTL_ADDR A:0x61108000
y.create.l HWIO_TLMM_RESOUT_HDRV_CTL_ADDR A:0x6110d000
y.create.l HWIO_TLMM_JTAG_HDRV_CTL_ADDR A:0x6110c000
y.create.l HWIO_TLMM_PMIC_HDRV_PULL_CTL_ADDR A:0x6110b000
y.create.l HWIO_TLMM_SDC1_HDRV_PULL_CTL_ADDR A:0x6110a000
y.create.l HWIO_TLMM_SDC2_HDRV_PULL_CTL_ADDR A:0x61109000
y.create.l HWIO_TLMM_MODE_PULL_CTL_ADDR A:0x61107000
y.create.l HWIO_TLMM_QDSD_HDRV_PULL_DEBUG_GPIO_CTL_ADDR A:0x6119c000
y.create.l HWIO_TLMM_QDSD_BOOT_CTL_ADDR A:0x6119d000
y.create.l HWIO_TLMM_QDSD_CONFIG_CTL_ADDR A:0x6119e000
y.create.l HWIO_TLMM_QDSD_STATUS_CTL_ADDR A:0x6119f000
y.create.l HWIO_TLMM_QDSD_HYS_CTL_ADDR A:0x611a7000
y.create.l HWIO_TLMM_QDSD_DEBUG_HDRV_PULL_CTL_ADDR A:0x611a0000
y.create.l HWIO_TLMM_QDSD_GPIO_CTL_ADDR A:0x611a1000
y.create.l HWIO_TLMM_QDSD_INTR_ENABLE_CTL_ADDR A:0x611a2000
y.create.l HWIO_TLMM_QDSD_INTR_CLEAR_CTL_ADDR A:0x611a3000
y.create.l HWIO_TLMM_QDSD_SPARE1_CTL_ADDR A:0x611a5000
y.create.l HWIO_TLMM_QDSD_SPARE2_CTL_ADDR A:0x611a6000
y.create.l HWIO_TLMM_QDSD_TIMEOUT_VALUE_CTL_ADDR A:0x611a4000
y.create.l HWIO_TLMM_GPIO_HS_I2C_CTL_ADDR A:0x6110f000
y.create.l HWIO_TLMM_DIR_CONN_INTR0_CFG_WCSS_ADDR A:0x61106000
y.create.l HWIO_TLMM_DIR_CONN_INTR1_CFG_WCSS_ADDR A:0x61106004
y.create.l HWIO_TLMM_DIR_CONN_INTR0_CFG_SENSORS_ADDR A:0x61105000
y.create.l HWIO_TLMM_DIR_CONN_INTR1_CFG_SENSORS_ADDR A:0x61105004
y.create.l HWIO_TLMM_DIR_CONN_INTR2_CFG_SENSORS_ADDR A:0x61105008
y.create.l HWIO_TLMM_DIR_CONN_INTR3_CFG_SENSORS_ADDR A:0x6110500c
y.create.l HWIO_TLMM_DIR_CONN_INTR4_CFG_SENSORS_ADDR A:0x61105010
y.create.l HWIO_TLMM_DIR_CONN_INTR5_CFG_SENSORS_ADDR A:0x61105014
y.create.l HWIO_TLMM_DIR_CONN_INTR6_CFG_SENSORS_ADDR A:0x61105018
y.create.l HWIO_TLMM_DIR_CONN_INTR7_CFG_SENSORS_ADDR A:0x6110501c
y.create.l HWIO_TLMM_DIR_CONN_INTR8_CFG_SENSORS_ADDR A:0x61105020
y.create.l HWIO_TLMM_DIR_CONN_INTR9_CFG_SENSORS_ADDR A:0x61105024
y.create.l HWIO_TLMM_DIR_CONN_INTR0_CFG_LPA_DSP_ADDR A:0x61104000
y.create.l HWIO_TLMM_DIR_CONN_INTR1_CFG_LPA_DSP_ADDR A:0x61104004
y.create.l HWIO_TLMM_DIR_CONN_INTR2_CFG_LPA_DSP_ADDR A:0x61104008
y.create.l HWIO_TLMM_DIR_CONN_INTR3_CFG_LPA_DSP_ADDR A:0x6110400c
y.create.l HWIO_TLMM_DIR_CONN_INTR4_CFG_LPA_DSP_ADDR A:0x61104010
y.create.l HWIO_TLMM_DIR_CONN_INTR5_CFG_LPA_DSP_ADDR A:0x61104014
y.create.l HWIO_TLMM_DIR_CONN_INTR0_CFG_RPM_ADDR A:0x61103000
y.create.l HWIO_TLMM_DIR_CONN_INTR0_CFG_APSS_ADDR A:0x61102000
y.create.l HWIO_TLMM_DIR_CONN_INTR1_CFG_APSS_ADDR A:0x61102004
y.create.l HWIO_TLMM_DIR_CONN_INTR2_CFG_APSS_ADDR A:0x61102008
y.create.l HWIO_TLMM_DIR_CONN_INTR3_CFG_APSS_ADDR A:0x6110200c
y.create.l HWIO_TLMM_DIR_CONN_INTR4_CFG_APSS_ADDR A:0x61102010
y.create.l HWIO_TLMM_DIR_CONN_INTR5_CFG_APSS_ADDR A:0x61102014
y.create.l HWIO_TLMM_DIR_CONN_INTR6_CFG_APSS_ADDR A:0x61102018
y.create.l HWIO_TLMM_DIR_CONN_INTR7_CFG_APSS_ADDR A:0x6110201c
y.create.l HWIO_TLMM_DIR_CONN_INTR0_CFG_MSS_ADDR A:0x61101000
y.create.l HWIO_TLMM_DIR_CONN_INTR1_CFG_MSS_ADDR A:0x61101004
y.create.l HWIO_TLMM_GPIO_OUT_0_ADDR A:0x61200000
y.create.l HWIO_TLMM_GPIO_OUT_1_ADDR A:0x61200004
y.create.l HWIO_TLMM_GPIO_OUT_2_ADDR A:0x61200008
y.create.l HWIO_TLMM_GPIO_OUT_3_ADDR A:0x6120000c
y.create.l HWIO_TLMM_GPIO_OUT_CLR_0_ADDR A:0x61200020
y.create.l HWIO_TLMM_GPIO_OUT_CLR_1_ADDR A:0x61200024
y.create.l HWIO_TLMM_GPIO_OUT_CLR_2_ADDR A:0x61200028
y.create.l HWIO_TLMM_GPIO_OUT_CLR_3_ADDR A:0x6120002c
y.create.l HWIO_TLMM_GPIO_OUT_SET_0_ADDR A:0x61200040
y.create.l HWIO_TLMM_GPIO_OUT_SET_1_ADDR A:0x61200044
y.create.l HWIO_TLMM_GPIO_OUT_SET_2_ADDR A:0x61200048
y.create.l HWIO_TLMM_GPIO_OUT_SET_3_ADDR A:0x6120004c
y.create.l HWIO_TLMM_GPIO_IN_0_ADDR A:0x61200060
y.create.l HWIO_TLMM_GPIO_IN_1_ADDR A:0x61200064
y.create.l HWIO_TLMM_GPIO_IN_2_ADDR A:0x61200068
y.create.l HWIO_TLMM_GPIO_IN_3_ADDR A:0x6120006c
y.create.l HWIO_TLMM_GPIO_OE_0_ADDR A:0x61200080
y.create.l HWIO_TLMM_GPIO_OE_1_ADDR A:0x61200084
y.create.l HWIO_TLMM_GPIO_OE_2_ADDR A:0x61200088
y.create.l HWIO_TLMM_GPIO_OE_3_ADDR A:0x6120008c
y.create.l HWIO_TLMM_GPIO_OE_CLR_0_ADDR A:0x612000a0
y.create.l HWIO_TLMM_GPIO_OE_CLR_1_ADDR A:0x612000a4
y.create.l HWIO_TLMM_GPIO_OE_CLR_2_ADDR A:0x612000a8
y.create.l HWIO_TLMM_GPIO_OE_CLR_3_ADDR A:0x612000ac
y.create.l HWIO_TLMM_GPIO_OE_SET_0_ADDR A:0x612000c0
y.create.l HWIO_TLMM_GPIO_OE_SET_1_ADDR A:0x612000c4
y.create.l HWIO_TLMM_GPIO_OE_SET_2_ADDR A:0x612000c8
y.create.l HWIO_TLMM_GPIO_OE_SET_3_ADDR A:0x612000cc
y.create.l HWIO_ULTAUDIO_HW_VERSION_ADDR A:0x67700000
y.create.l HWIO_ULTAUDIO_TCSR_DEBUG_CTL_ADDR A:0x67700004
y.create.l HWIO_LPASS_CSR_GP_CTL_ADDR A:0x67700100
y.create.l HWIO_LPASS_CSR_MEMTYPE_CTL_ADDR A:0x67700104
y.create.l HWIO_LPASS_CSR_DEBUG_BUS_ADDR A:0x67700114
y.create.l HWIO_LPASS_AHBI_CFG_ADDR A:0x67700124
y.create.l HWIO_LPASS_AHBI_LOCK_CTL_ADDR A:0x67700128
y.create.l HWIO_LPASS_AHBI_CFG_EXT_ADDR A:0x6770012c
y.create.l HWIO_LPASS_AHBX_CFG_ADDR A:0x67700140
y.create.l HWIO_LPASS_AHBX_LOCK_CTL_ADDR A:0x67700144
y.create.l HWIO_LPASS_AHBIX_SSR_CTL_ADDR A:0x67700148
y.create.l HWIO_LPASS_AHBIX_STATUS_ADDR A:0x67700150
y.create.l HWIO_LPASS_AHBIX_ACK_ADDR A:0x67700154
y.create.l HWIO_LPASS_AHBIX_EN_ADDR A:0x67700158
y.create.l HWIO_LPASS_AUDIO_CORE_LPM_CGCR_ADDR A:0x6770015c
y.create.l HWIO_LPASS_AUDIO_CORE_AUDSYNC_CGCR_ADDR A:0x67700160
y.create.l HWIO_LPASS_AUDIO_CORE_AVSYNC_CGCR_ADDR A:0x67700164
y.create.l HWIO_LPASS_AUDIO_CORE_AHB2AHB_CODEC_CGCR_ADDR A:0x6770016c
y.create.l HWIO_LPASS_AUDIO_CORE_LPAIF_CTL_CGCR_ADDR A:0x67700170
y.create.l HWIO_LPASS_AUDIO_CORE_VFR_CGCR_ADDR A:0x67700174
y.create.l HWIO_LPASS_AUDIO_CORE_AHB2AHB_PCNOC_SLV_CGCR_ADDR A:0x67700178
y.create.l HWIO_LPASS_AUDIO_CORE_AHB2AHB_PCNOC_MST_CGCR_ADDR A:0x6770017c
y.create.l HWIO_LPASS_AUDIO_CORE_AVTIMER_XO_FM_CGCR_ADDR A:0x67700180
y.create.l HWIO_LPASS_AUDIO_CORE_AVTIMER_XO_BT_CGCR_ADDR A:0x67700184
y.create.l HWIO_LPASS_AUDIO_CORE_SLIMBUS_SLV_CGCR_ADDR A:0x67700188
y.create.l HWIO_LPASS_AUDIO_CORE_SLIMBUS_MST_CGCR_ADDR A:0x6770018c
y.create.l HWIO_LPASS_LPASS_CSR_ADDR_VALID_STATUS_ADDR A:0x67700190
y.create.l HWIO_LPASS_LPASS_CSR_ADDR_VALID_ACK_ADDR A:0x67700194
y.create.l HWIO_LPASS_LPASS_CSR_ADDR_VALID_EN_ADDR A:0x67700198
y.create.l HWIO_LPASS_LPM_CTL_ADDR A:0x6770019c
y.create.l HWIO_LPASS_LPAIF_CTL_ADDR A:0x677001b0
y.create.l HWIO_LPASS_VFR_IRQ_MUX_CTL_ADDR A:0x67701000
y.create.l HWIO_LPASS_VFR_STC_MSB_ADDR A:0x67701004
y.create.l HWIO_LPASS_VFR_STC_LSB_ADDR A:0x67701008
y.create.l HWIO_LPASS_VFR_IRQ_MUX_CTL_1_ADDR A:0x67701010
y.create.l HWIO_LPASS_VFR_STC_MSB_1_ADDR A:0x67701014
y.create.l HWIO_LPASS_VFR_STC_LSB_1_ADDR A:0x67701018
y.create.l HWIO_LPASS_GP_IRQ_TS_MUX_CTL_0_ADDR A:0x67701020
y.create.l HWIO_LPASS_GP_IRQ_STC_MSB_0_ADDR A:0x67701024
y.create.l HWIO_LPASS_GP_IRQ_STC_LSB_0_ADDR A:0x67701028
y.create.l HWIO_LPASS_GP_IRQ_TS_MUX_CTL_1_ADDR A:0x67701030
y.create.l HWIO_LPASS_GP_IRQ_STC_MSB_1_ADDR A:0x67701034
y.create.l HWIO_LPASS_GP_IRQ_STC_LSB_1_ADDR A:0x67701038
y.create.l HWIO_LPASS_LPAIF_VFR_IRQ_CTL_ADDR A:0x67701040
y.create.l HWIO_LPASS_WCN_VFR_IRQ_CTL_ADDR A:0x67701044
y.create.l HWIO_LPASS_AVT_VFR_IRQ_CTL_ADDR A:0x67701048
y.create.l HWIO_LPASS_SLIMBUS_VFR_IRQ_CTL_ADDR A:0x6770104c
y.create.l HWIO_LPASS_CSR_GP_IO_MUX_MIC_CTL_ADDR A:0x67702000
y.create.l HWIO_LPASS_CSR_GP_IO_MUX_SPKR_CTL_ADDR A:0x67702004
y.create.l HWIO_LPASS_CSR_GP_LPAIF_PRI_PCM_PRI_MODE_MUXSEL_ADDR A:0x67702008
y.create.l HWIO_LPASS_CSR_GP_LPAIF_SEC_PCM_SEC_MODE_MUXSEL_ADDR A:0x6770200c
y.create.l HWIO_LPASS_CSR_GP_LPAIF_TER_PCM_PRI_MODE_MUXSEL_ADDR A:0x67702010
y.create.l HWIO_LPASS_AHBI_ABT_HW_VERSION_ADDR A:0x67705000
y.create.l HWIO_LPASS_AHBI_ABT_INST_ID_ADDR A:0x67705004
y.create.l HWIO_LPASS_AHBI_ABT_NUM_SLAVES_ADDR A:0x67705008
y.create.l HWIO_LPASS_AHBI_ABT_TIMER_LOADVAL_ADDR A:0x6770500c
y.create.l HWIO_LPASS_AHBI_ABT_TIMER_MODE_ADDR A:0x67705010
y.create.l HWIO_LPASS_AHBI_ABT_INTR_STATUS_ADDR A:0x67705014
y.create.l HWIO_LPASS_AHBI_ABT_INTR_CLEAR_ADDR A:0x67705018
y.create.l HWIO_LPASS_AHBI_ABT_INTR_ENABLE_ADDR A:0x6770501c
y.create.l HWIO_LPASS_AHBI_ABT_SYND_VALID_ADDR A:0x67705020
y.create.l HWIO_LPASS_AHBI_ABT_SYND_CLEAR_ADDR A:0x67705024
y.create.l HWIO_LPASS_AHBI_ABT_SYND_ID_ADDR A:0x67705028
y.create.l HWIO_LPASS_AHBI_ABT_SYND_ADDR0_ADDR A:0x6770502c
y.create.l HWIO_LPASS_AHBI_ABT_SYND_ADDR1_ADDR A:0x67705030
y.create.l HWIO_LPASS_AHBI_ABT_SYND_HREADY_ADDR A:0x67705034
y.create.l HWIO_LPASS_AVTIMER_HW_VERSION_ADDR A:0x67706000
y.create.l HWIO_LPASS_AVTIMER_CTL_ADDR A:0x67706004
y.create.l HWIO_LPASS_AVTIMER_RESMOD_ADDR A:0x67706008
y.create.l HWIO_LPASS_AVTIMER_TIMER_LSB_ADDR A:0x6770600c
y.create.l HWIO_LPASS_AVTIMER_TIMER_MSB_ADDR A:0x67706010
y.create.l HWIO_LPASS_AVTIMER_INT0_LSB_ADDR A:0x67706014
y.create.l HWIO_LPASS_AVTIMER_INT0_MSB_ADDR A:0x67706018
y.create.l HWIO_LPASS_AVTIMER_INT1_LSB_ADDR A:0x6770601c
y.create.l HWIO_LPASS_AVTIMER_INT1_MSB_ADDR A:0x67706020
y.create.l HWIO_LPASS_AVTIMER_TIMEOUT_VAL_ADDR A:0x67706024
y.create.l HWIO_LPASS_AVTIMER_L0_VAL_NEXT_ADDR A:0x67706028
y.create.l HWIO_LPASS_AVTIMER_M0_VAL_NEXT_ADDR A:0x6770602c
y.create.l HWIO_LPASS_AVTIMER_N0_VAL_NEXT_ADDR A:0x67706030
y.create.l HWIO_LPASS_AVTIMER_L0_VAL_CURR_ADDR A:0x67706034
y.create.l HWIO_LPASS_AVTIMER_M0_VAL_CURR_ADDR A:0x67706038
y.create.l HWIO_LPASS_AVTIMER_N0_VAL_CURR_ADDR A:0x6770603c
y.create.l HWIO_LPASS_AVTIMER_MODE_CTL_ADDR A:0x67706040
y.create.l HWIO_LPASS_AVTIMER_LMN_DWT_ADDR A:0x67706044
y.create.l HWIO_LPASS_AVTIMER_LTIME_LSB_ADDR A:0x67706048
y.create.l HWIO_LPASS_AVTIMER_LTIME_MSB_ADDR A:0x6770604c
y.create.l HWIO_LPASS_AVTIMER_EXT_STC_LSB_ADDR A:0x67706050
y.create.l HWIO_LPASS_AVTIMER_EXT_STC_MSB_ADDR A:0x67706054
y.create.l HWIO_LPASS_AVTIMER_RTIME_LSB_ADDR A:0x67706058
y.create.l HWIO_LPASS_AVTIMER_RTIME_MSB_ADDR A:0x6770605c
y.create.l HWIO_LPASS_AVTIMER_RTIME_CTL_ADDR A:0x67706060
y.create.l HWIO_LPASS_AVTIMER_TIME_CTL_ADDR A:0x67706064
y.create.l HWIO_LPASS_AVTIMER_TIMER_LOAD_LSB_NEXT_ADDR A:0x67706068
y.create.l HWIO_LPASS_AVTIMER_TIMER_LOAD_MSB_NEXT_ADDR A:0x6770606c
y.create.l HWIO_LPASS_AVTIMER_TIMER_LOAD_LSB_CURR_ADDR A:0x67706070
y.create.l HWIO_LPASS_AVTIMER_TIMER_LOAD_MSB_CURR_ADDR A:0x67706074
y.create.l HWIO_LPASS_AVTIMER_TIMER_LOAD_DWT_ADDR A:0x67706078
y.create.l HWIO_LPASS_AVTIMER_INT1_ST_ADDR A:0x6770607c
y.create.l HWIO_LPASS_AVTIMER_INT0_ST_ADDR A:0x67706080
y.create.l HWIO_LPASS_AVTIMER_INT1_CTL_ADDR A:0x67706084
y.create.l HWIO_LPASS_AVTIMER_INT0_CTL_ADDR A:0x67706088
y.create.l HWIO_LPASS_AVTIMER_INT_ON_ADDR A:0x6770608c
y.create.l HWIO_LPASS_AVTIMER_TICK_DIV_ADDR A:0x67706090
y.create.l HWIO_LPASS_AUD_SYNC_CTL_ADDR A:0x67707000
y.create.l HWIO_LPASS_AUD_SYNC_STATUS_ADDR A:0x67707004
y.create.l HWIO_LPASS_AUD_SYNC_BT_REF_INC_ADDR A:0x67707008
y.create.l HWIO_LPASS_AUD_SYNC_BT_XO_DIV_MOD_ADDR A:0x6770700c
y.create.l HWIO_LPASS_AUD_SYNC_BT_PHASE_CHK_XO1_ADDR A:0x67707010
y.create.l HWIO_LPASS_AUD_SYNC_BT_PHASE_CHK_REF1_ADDR A:0x67707014
y.create.l HWIO_LPASS_AUD_SYNC_BT_VFR_TIMESTAMP_ADDR A:0x67707018
y.create.l HWIO_LPASS_AUD_SYNC_BT_COUNT_LOAD_XO1_ADDR A:0x6770701c
y.create.l HWIO_LPASS_AUD_SYNC_BT_COUNT_LOAD_REF1_ADDR A:0x67707020
y.create.l HWIO_LPASS_AUD_SYNC_BT_PHASE_CHK_XO2_ADDR A:0x67707024
y.create.l HWIO_LPASS_AUD_SYNC_BT_PHASE_CHK_REF2_ADDR A:0x67707028
y.create.l HWIO_LPASS_AUD_SYNC_BT_COUNT_LOAD_XO2_ADDR A:0x6770702c
y.create.l HWIO_LPASS_AUD_SYNC_BT_COUNT_LOAD_REF2_ADDR A:0x67707030
y.create.l HWIO_LPASS_AUD_SYNC_FM_REF_INC_ADDR A:0x67707034
y.create.l HWIO_LPASS_AUD_SYNC_FM_XO_DIV_MOD_ADDR A:0x67707038
y.create.l HWIO_LPASS_AUD_SYNC_FM_PHASE_CHK_XO_ADDR A:0x6770703c
y.create.l HWIO_LPASS_AUD_SYNC_FM_PHASE_CHK_REF_ADDR A:0x67707040
y.create.l HWIO_LPASS_AUD_SYNC_FM_VFR_TIMESTAMP_ADDR A:0x67707044
y.create.l HWIO_LPASS_AUD_SYNC_FM_COUNT_LOAD_XO_ADDR A:0x67707048
y.create.l HWIO_LPASS_AUD_SYNC_FM_COUNT_LOAD_REF_ADDR A:0x6770704c
y.create.l HWIO_LPASS_LPAIF_VERSION_ADDR A:0x67708000
y.create.l HWIO_LPASS_LPAIF_HW_CONFIG_ADDR A:0x67708004
y.create.l HWIO_LPASS_LPAIF_HW_CONFIG2_ADDR A:0x67708008
y.create.l HWIO_LPASS_LPAIF_DMIC_CTL_ADDR A:0x67708080
y.create.l HWIO_LPASS_LPAIF_DMIC_VOL_CTL0_ADDR A:0x67708084
y.create.l HWIO_LPASS_LPAIF_DMIC_VOL_CTL1_ADDR A:0x67708088
y.create.l HWIO_LPASS_LPAIF_WRDMA_LPBK_MIX_ADDR A:0x67708100
y.create.l HWIO_LPASS_LPAIF_MIXER_CTL_ADDR A:0x67708180
y.create.l HWIO_LPASS_LPAIF_EXT_VFR_ADDR A:0x67708200
y.create.l HWIO_LPASS_LPAIF_DEBUG_CTL_ADDR A:0x67708280
y.create.l HWIO_LPASS_LPAIF_PRI_RATE_DET_CONFIG_ADDR A:0x67708300
y.create.l HWIO_LPASS_LPAIF_PRI_RATE_DET_TARGET1_CONFIG_ADDR A:0x67708304
y.create.l HWIO_LPASS_LPAIF_PRI_RATE_DET_TARGET2_CONFIG_ADDR A:0x67708308
y.create.l HWIO_LPASS_LPAIF_PRI_RATE_BIN_ADDR A:0x6770830c
y.create.l HWIO_LPASS_LPAIF_PRI_STC_DIFF_ADDR A:0x67708310
y.create.l HWIO_LPASS_LPAIF_SEC_RATE_DET_CONFIG_ADDR A:0x67708380
y.create.l HWIO_LPASS_LPAIF_SEC_RATE_DET_TARGET1_CONFIG_ADDR A:0x67708384
y.create.l HWIO_LPASS_LPAIF_SEC_RATE_DET_TARGET2_CONFIG_ADDR A:0x67708388
y.create.l HWIO_LPASS_LPAIF_SEC_RATE_BIN_ADDR A:0x6770838c
y.create.l HWIO_LPASS_LPAIF_SEC_STC_DIFF_ADDR A:0x67708390
y.create.l HWIO_LPASS_LPAIF_SPARE_ADDR A:0x67708400
y.create.l HWIO_LPASS_LPAIF_I2S_CTL0_ADDR A:0x67709000
y.create.l HWIO_LPASS_LPAIF_I2S_CTL1_ADDR A:0x6770a000
y.create.l HWIO_LPASS_LPAIF_I2S_CTL2_ADDR A:0x6770b000
y.create.l HWIO_LPASS_LPAIF_I2S_CTL3_ADDR A:0x6770c000
y.create.l HWIO_LPASS_LPAIF_PCM_CTL0_ADDR A:0x67709040
y.create.l HWIO_LPASS_LPAIF_PCM_SLOT_CTL0_ADDR A:0x67709044
y.create.l HWIO_LPASS_LPAIF_PCM_SLOT_CTL2_0_ADDR A:0x67709048
y.create.l HWIO_LPASS_LPAIF_PCM_SLOT_CTL3_0_ADDR A:0x6770904c
y.create.l HWIO_LPASS_LPAIF_PCM_TDM_CTL_0_ADDR A:0x67709050
y.create.l HWIO_LPASS_LPAIF_PCM_TDM_SAMPLE_WIDTH_0_ADDR A:0x67709054
y.create.l HWIO_LPASS_LPAIF_IRQ_EN0_ADDR A:0x6770e000
y.create.l HWIO_LPASS_LPAIF_IRQ_EN1_ADDR A:0x6770f000
y.create.l HWIO_LPASS_LPAIF_IRQ_EN2_ADDR A:0x67710000
y.create.l HWIO_LPASS_LPAIF_IRQ_STAT0_ADDR A:0x6770e004
y.create.l HWIO_LPASS_LPAIF_IRQ_STAT1_ADDR A:0x6770f004
y.create.l HWIO_LPASS_LPAIF_IRQ_STAT2_ADDR A:0x67710004
y.create.l HWIO_LPASS_LPAIF_IRQ_RAW_STAT0_ADDR A:0x6770e008
y.create.l HWIO_LPASS_LPAIF_IRQ_RAW_STAT1_ADDR A:0x6770f008
y.create.l HWIO_LPASS_LPAIF_IRQ_RAW_STAT2_ADDR A:0x67710008
y.create.l HWIO_LPASS_LPAIF_IRQ_CLEAR0_ADDR A:0x6770e00c
y.create.l HWIO_LPASS_LPAIF_IRQ_CLEAR1_ADDR A:0x6770f00c
y.create.l HWIO_LPASS_LPAIF_IRQ_CLEAR2_ADDR A:0x6771000c
y.create.l HWIO_LPASS_LPAIF_IRQ_FORCE0_ADDR A:0x6770e010
y.create.l HWIO_LPASS_LPAIF_IRQ_FORCE1_ADDR A:0x6770f010
y.create.l HWIO_LPASS_LPAIF_IRQ_FORCE2_ADDR A:0x67710010
y.create.l HWIO_LPASS_LPAIF_RDDMA_CTL0_ADDR A:0x67710400
y.create.l HWIO_LPASS_LPAIF_RDDMA_CTL1_ADDR A:0x67711400
y.create.l HWIO_LPASS_LPAIF_RDDMA_BASE0_ADDR A:0x67710404
y.create.l HWIO_LPASS_LPAIF_RDDMA_BASE1_ADDR A:0x67711404
y.create.l HWIO_LPASS_LPAIF_RDDMA_BUFF_LEN0_ADDR A:0x67710408
y.create.l HWIO_LPASS_LPAIF_RDDMA_BUFF_LEN1_ADDR A:0x67711408
y.create.l HWIO_LPASS_LPAIF_RDDMA_CURR_ADDR0_ADDR A:0x6771040c
y.create.l HWIO_LPASS_LPAIF_RDDMA_CURR_ADDR1_ADDR A:0x6771140c
y.create.l HWIO_LPASS_LPAIF_RDDMA_PER_LEN0_ADDR A:0x67710410
y.create.l HWIO_LPASS_LPAIF_RDDMA_PER_LEN1_ADDR A:0x67711410
y.create.l HWIO_LPASS_LPAIF_RDDMA_PER_CNT0_ADDR A:0x67710414
y.create.l HWIO_LPASS_LPAIF_RDDMA_PER_CNT1_ADDR A:0x67711414
y.create.l HWIO_LPASS_LPAIF_RDDMA_FRM0_ADDR A:0x67710418
y.create.l HWIO_LPASS_LPAIF_RDDMA_FRM1_ADDR A:0x67711418
y.create.l HWIO_LPASS_LPAIF_RDDMA_FRMCLR0_ADDR A:0x6771041c
y.create.l HWIO_LPASS_LPAIF_RDDMA_FRMCLR1_ADDR A:0x6771141c
y.create.l HWIO_LPASS_LPAIF_RDDMA_SET_BUFF_CNT0_ADDR A:0x67710420
y.create.l HWIO_LPASS_LPAIF_RDDMA_SET_BUFF_CNT1_ADDR A:0x67711420
y.create.l HWIO_LPASS_LPAIF_RDDMA_SET_PER_CNT0_ADDR A:0x67710424
y.create.l HWIO_LPASS_LPAIF_RDDMA_SET_PER_CNT1_ADDR A:0x67711424
y.create.l HWIO_LPASS_LPAIF_RDDMA_STC_LSB0_ADDR A:0x67710428
y.create.l HWIO_LPASS_LPAIF_RDDMA_STC_LSB1_ADDR A:0x67711428
y.create.l HWIO_LPASS_LPAIF_RDDMA_STC_MSB0_ADDR A:0x6771042c
y.create.l HWIO_LPASS_LPAIF_RDDMA_STC_MSB1_ADDR A:0x6771142c
y.create.l HWIO_LPASS_LPAIF_RDDMA_PER0_ADDR A:0x67710430
y.create.l HWIO_LPASS_LPAIF_RDDMA_PER1_ADDR A:0x67711430
y.create.l HWIO_LPASS_LPAIF_RDDMA_PERCLR0_ADDR A:0x67710434
y.create.l HWIO_LPASS_LPAIF_RDDMA_PERCLR1_ADDR A:0x67711434
y.create.l HWIO_LPASS_LPAIF_RDDMA_BASE_EXT0_ADDR A:0x67710438
y.create.l HWIO_LPASS_LPAIF_RDDMA_BASE_EXT1_ADDR A:0x67711438
y.create.l HWIO_LPASS_LPAIF_RDDMA_CURR_ADDR_EXT0_ADDR A:0x6771043c
y.create.l HWIO_LPASS_LPAIF_RDDMA_CURR_ADDR_EXT1_ADDR A:0x6771143c
y.create.l HWIO_LPASS_LPAIF_WRDMA_CTL0_ADDR A:0x67713000
y.create.l HWIO_LPASS_LPAIF_WRDMA_CTL1_ADDR A:0x67714000
y.create.l HWIO_LPASS_LPAIF_WRDMA_BASE0_ADDR A:0x67713004
y.create.l HWIO_LPASS_LPAIF_WRDMA_BASE1_ADDR A:0x67714004
y.create.l HWIO_LPASS_LPAIF_WRDMA_BUFF_LEN0_ADDR A:0x67713008
y.create.l HWIO_LPASS_LPAIF_WRDMA_BUFF_LEN1_ADDR A:0x67714008
y.create.l HWIO_LPASS_LPAIF_WRDMA_CURR_ADDR0_ADDR A:0x6771300c
y.create.l HWIO_LPASS_LPAIF_WRDMA_CURR_ADDR1_ADDR A:0x6771400c
y.create.l HWIO_LPASS_LPAIF_WRDMA_PER_LEN0_ADDR A:0x67713010
y.create.l HWIO_LPASS_LPAIF_WRDMA_PER_LEN1_ADDR A:0x67714010
y.create.l HWIO_LPASS_LPAIF_WRDMA_PER_CNT0_ADDR A:0x67713014
y.create.l HWIO_LPASS_LPAIF_WRDMA_PER_CNT1_ADDR A:0x67714014
y.create.l HWIO_LPASS_LPAIF_WRDMA_FRM0_ADDR A:0x67713018
y.create.l HWIO_LPASS_LPAIF_WRDMA_FRM1_ADDR A:0x67714018
y.create.l HWIO_LPASS_LPAIF_WRDMA_FRMCLR0_ADDR A:0x6771301c
y.create.l HWIO_LPASS_LPAIF_WRDMA_FRMCLR1_ADDR A:0x6771401c
y.create.l HWIO_LPASS_LPAIF_WRDMA_SET_BUFF_CNT0_ADDR A:0x67713020
y.create.l HWIO_LPASS_LPAIF_WRDMA_SET_BUFF_CNT1_ADDR A:0x67714020
y.create.l HWIO_LPASS_LPAIF_WRDMA_SET_PER_CNT0_ADDR A:0x67713024
y.create.l HWIO_LPASS_LPAIF_WRDMA_SET_PER_CNT1_ADDR A:0x67714024
y.create.l HWIO_LPASS_LPAIF_WRDMA_STC_LSB0_ADDR A:0x67713028
y.create.l HWIO_LPASS_LPAIF_WRDMA_STC_LSB1_ADDR A:0x67714028
y.create.l HWIO_LPASS_LPAIF_WRDMA_STC_MSB0_ADDR A:0x6771302c
y.create.l HWIO_LPASS_LPAIF_WRDMA_STC_MSB1_ADDR A:0x6771402c
y.create.l HWIO_LPASS_LPAIF_WRDMA_PER0_ADDR A:0x67713030
y.create.l HWIO_LPASS_LPAIF_WRDMA_PER1_ADDR A:0x67714030
y.create.l HWIO_LPASS_LPAIF_WRDMA_PERCLR0_ADDR A:0x67713034
y.create.l HWIO_LPASS_LPAIF_WRDMA_PERCLR1_ADDR A:0x67714034
y.create.l HWIO_LPASS_LPAIF_WRDMA_BASE_EXT0_ADDR A:0x67713038
y.create.l HWIO_LPASS_LPAIF_WRDMA_BASE_EXT1_ADDR A:0x67714038
y.create.l HWIO_LPASS_LPAIF_WRDMA_CURR_ADDR_EXT0_ADDR A:0x6771303c
y.create.l HWIO_LPASS_LPAIF_WRDMA_CURR_ADDR_EXT1_ADDR A:0x6771403c
y.create.l HWIO_LPASS_CDC_CLK_RX_RESET_CTL_ADDR A:0x6771c000
y.create.l HWIO_LPASS_CDC_CLK_TX_RESET_B1_CTL_ADDR A:0x6771c004
y.create.l HWIO_LPASS_CDC_CLK_DMIC_B1_CTL_ADDR A:0x6771c008
y.create.l HWIO_LPASS_CDC_CLK_RX_I2S_CTL_ADDR A:0x6771c00c
y.create.l HWIO_LPASS_CDC_CLK_TX_I2S_CTL_ADDR A:0x6771c010
y.create.l HWIO_LPASS_CDC_CLK_OTHR_RESET_B1_CTL_ADDR A:0x6771c014
y.create.l HWIO_LPASS_CDC_CLK_TX_CLK_EN_B1_CTL_ADDR A:0x6771c018
y.create.l HWIO_LPASS_CDC_CLK_OTHR_CTL_ADDR A:0x6771c01c
y.create.l HWIO_LPASS_CDC_CLK_RX_B1_CTL_ADDR A:0x6771c020
y.create.l HWIO_LPASS_CDC_CLK_MCLK_CTL_ADDR A:0x6771c024
y.create.l HWIO_LPASS_CDC_CLK_PDM_CTL_ADDR A:0x6771c028
y.create.l HWIO_LPASS_CDC_CLK_SD_CTL_ADDR A:0x6771c02c
y.create.l HWIO_LPASS_CDC_RX1_B1_CTL_ADDR A:0x6771c040
y.create.l HWIO_LPASS_CDC_RX2_B1_CTL_ADDR A:0x6771c060
y.create.l HWIO_LPASS_CDC_RX3_B1_CTL_ADDR A:0x6771c080
y.create.l HWIO_LPASS_CDC_RX1_B2_CTL_ADDR A:0x6771c044
y.create.l HWIO_LPASS_CDC_RX2_B2_CTL_ADDR A:0x6771c064
y.create.l HWIO_LPASS_CDC_RX3_B2_CTL_ADDR A:0x6771c084
y.create.l HWIO_LPASS_CDC_RX1_B3_CTL_ADDR A:0x6771c048
y.create.l HWIO_LPASS_CDC_RX2_B3_CTL_ADDR A:0x6771c068
y.create.l HWIO_LPASS_CDC_RX3_B3_CTL_ADDR A:0x6771c088
y.create.l HWIO_LPASS_CDC_RX1_B4_CTL_ADDR A:0x6771c04c
y.create.l HWIO_LPASS_CDC_RX2_B4_CTL_ADDR A:0x6771c06c
y.create.l HWIO_LPASS_CDC_RX3_B4_CTL_ADDR A:0x6771c08c
y.create.l HWIO_LPASS_CDC_RX1_B5_CTL_ADDR A:0x6771c050
y.create.l HWIO_LPASS_CDC_RX2_B5_CTL_ADDR A:0x6771c070
y.create.l HWIO_LPASS_CDC_RX3_B5_CTL_ADDR A:0x6771c090
y.create.l HWIO_LPASS_CDC_RX1_B6_CTL_ADDR A:0x6771c054
y.create.l HWIO_LPASS_CDC_RX2_B6_CTL_ADDR A:0x6771c074
y.create.l HWIO_LPASS_CDC_RX3_B6_CTL_ADDR A:0x6771c094
y.create.l HWIO_LPASS_CDC_RX1_VOL_CTL_B1_CTL_ADDR A:0x6771c058
y.create.l HWIO_LPASS_CDC_RX2_VOL_CTL_B1_CTL_ADDR A:0x6771c078
y.create.l HWIO_LPASS_CDC_RX3_VOL_CTL_B1_CTL_ADDR A:0x6771c098
y.create.l HWIO_LPASS_CDC_RX1_VOL_CTL_B2_CTL_ADDR A:0x6771c05c
y.create.l HWIO_LPASS_CDC_RX2_VOL_CTL_B2_CTL_ADDR A:0x6771c07c
y.create.l HWIO_LPASS_CDC_RX3_VOL_CTL_B2_CTL_ADDR A:0x6771c09c
y.create.l HWIO_LPASS_CDC_TOP_GAIN_UPDATE_ADDR A:0x6771c0a0
y.create.l HWIO_LPASS_CDC_TOP_CTL_ADDR A:0x6771c0a4
y.create.l HWIO_LPASS_CDC_DEBUG_DESER1_CTL_ADDR A:0x6771c0e0
y.create.l HWIO_LPASS_CDC_DEBUG_DESER2_CTL_ADDR A:0x6771c0e4
y.create.l HWIO_LPASS_CDC_DEBUG_B1_CTL_ADDR A:0x6771c0e8
y.create.l HWIO_LPASS_CDC_DEBUG_B2_CTL_ADDR A:0x6771c0ec
y.create.l HWIO_LPASS_CDC_DEBUG_B3_CTL_ADDR A:0x6771c0f0
y.create.l HWIO_LPASS_CDC_IIR1_GAIN_B1_CTL_ADDR A:0x6771c100
y.create.l HWIO_LPASS_CDC_IIR2_GAIN_B1_CTL_ADDR A:0x6771c140
y.create.l HWIO_LPASS_CDC_IIR1_GAIN_B2_CTL_ADDR A:0x6771c104
y.create.l HWIO_LPASS_CDC_IIR2_GAIN_B2_CTL_ADDR A:0x6771c144
y.create.l HWIO_LPASS_CDC_IIR1_GAIN_B3_CTL_ADDR A:0x6771c108
y.create.l HWIO_LPASS_CDC_IIR2_GAIN_B3_CTL_ADDR A:0x6771c148
y.create.l HWIO_LPASS_CDC_IIR1_GAIN_B4_CTL_ADDR A:0x6771c10c
y.create.l HWIO_LPASS_CDC_IIR2_GAIN_B4_CTL_ADDR A:0x6771c14c
y.create.l HWIO_LPASS_CDC_IIR1_GAIN_B5_CTL_ADDR A:0x6771c110
y.create.l HWIO_LPASS_CDC_IIR2_GAIN_B5_CTL_ADDR A:0x6771c150
y.create.l HWIO_LPASS_CDC_IIR1_GAIN_B6_CTL_ADDR A:0x6771c114
y.create.l HWIO_LPASS_CDC_IIR2_GAIN_B6_CTL_ADDR A:0x6771c154
y.create.l HWIO_LPASS_CDC_IIR1_GAIN_B7_CTL_ADDR A:0x6771c118
y.create.l HWIO_LPASS_CDC_IIR2_GAIN_B7_CTL_ADDR A:0x6771c158
y.create.l HWIO_LPASS_CDC_IIR1_GAIN_B8_CTL_ADDR A:0x6771c11c
y.create.l HWIO_LPASS_CDC_IIR2_GAIN_B8_CTL_ADDR A:0x6771c15c
y.create.l HWIO_LPASS_CDC_IIR1_CTL_ADDR A:0x6771c120
y.create.l HWIO_LPASS_CDC_IIR2_CTL_ADDR A:0x6771c160
y.create.l HWIO_LPASS_CDC_IIR1_GAIN_TIMER_CTL_ADDR A:0x6771c124
y.create.l HWIO_LPASS_CDC_IIR2_GAIN_TIMER_CTL_ADDR A:0x6771c164
y.create.l HWIO_LPASS_CDC_IIR1_COEF_B1_CTL_ADDR A:0x6771c128
y.create.l HWIO_LPASS_CDC_IIR2_COEF_B1_CTL_ADDR A:0x6771c168
y.create.l HWIO_LPASS_CDC_IIR1_COEF_B2_CTL_ADDR A:0x6771c12c
y.create.l HWIO_LPASS_CDC_IIR2_COEF_B2_CTL_ADDR A:0x6771c16c
y.create.l HWIO_LPASS_CDC_CONN_RX1_B1_CTL_ADDR A:0x6771c180
y.create.l HWIO_LPASS_CDC_CONN_RX1_B2_CTL_ADDR A:0x6771c184
y.create.l HWIO_LPASS_CDC_CONN_RX1_B3_CTL_ADDR A:0x6771c188
y.create.l HWIO_LPASS_CDC_CONN_RX2_B1_CTL_ADDR A:0x6771c18c
y.create.l HWIO_LPASS_CDC_CONN_RX2_B2_CTL_ADDR A:0x6771c190
y.create.l HWIO_LPASS_CDC_CONN_RX2_B3_CTL_ADDR A:0x6771c194
y.create.l HWIO_LPASS_CDC_CONN_RX3_B1_CTL_ADDR A:0x6771c198
y.create.l HWIO_LPASS_CDC_CONN_RX3_B2_CTL_ADDR A:0x6771c19c
y.create.l HWIO_LPASS_CDC_CONN_TX_B1_CTL_ADDR A:0x6771c1a0
y.create.l HWIO_LPASS_CDC_CONN_EQ1_B1_CTL_ADDR A:0x6771c1a8
y.create.l HWIO_LPASS_CDC_CONN_EQ1_B2_CTL_ADDR A:0x6771c1ac
y.create.l HWIO_LPASS_CDC_CONN_EQ1_B3_CTL_ADDR A:0x6771c1b0
y.create.l HWIO_LPASS_CDC_CONN_EQ1_B4_CTL_ADDR A:0x6771c1b4
y.create.l HWIO_LPASS_CDC_CONN_EQ2_B1_CTL_ADDR A:0x6771c1b8
y.create.l HWIO_LPASS_CDC_CONN_EQ2_B2_CTL_ADDR A:0x6771c1bc
y.create.l HWIO_LPASS_CDC_CONN_EQ2_B3_CTL_ADDR A:0x6771c1c0
y.create.l HWIO_LPASS_CDC_CONN_EQ2_B4_CTL_ADDR A:0x6771c1c4
y.create.l HWIO_LPASS_CDC_CONN_TX_I2S_SD1_CTL_ADDR A:0x6771c1c8
y.create.l HWIO_LPASS_CDC_TX1_VOL_CTL_TIMER_ADDR A:0x6771c280
y.create.l HWIO_LPASS_CDC_TX2_VOL_CTL_TIMER_ADDR A:0x6771c2a0
y.create.l HWIO_LPASS_CDC_TX1_VOL_CTL_GAIN_ADDR A:0x6771c284
y.create.l HWIO_LPASS_CDC_TX2_VOL_CTL_GAIN_ADDR A:0x6771c2a4
y.create.l HWIO_LPASS_CDC_TX1_VOL_CTL_CFG_ADDR A:0x6771c288
y.create.l HWIO_LPASS_CDC_TX2_VOL_CTL_CFG_ADDR A:0x6771c2a8
y.create.l HWIO_LPASS_CDC_TX1_MUX_CTL_ADDR A:0x6771c28c
y.create.l HWIO_LPASS_CDC_TX2_MUX_CTL_ADDR A:0x6771c2ac
y.create.l HWIO_LPASS_CDC_TX1_CLK_FS_CTL_ADDR A:0x6771c290
y.create.l HWIO_LPASS_CDC_TX2_CLK_FS_CTL_ADDR A:0x6771c2b0
y.create.l HWIO_LPASS_CDC_TX1_DMIC_CTL_ADDR A:0x6771c294
y.create.l HWIO_LPASS_CDC_TX2_DMIC_CTL_ADDR A:0x6771c2b4
y.create.l HWIO_USB2_HSIC_USB_OTG_HS_ID_ADDR A:0x678d9000
y.create.l HWIO_USB2_HSIC_USB_OTG_HS_HWGENERAL_ADDR A:0x678d9004
y.create.l HWIO_USB2_HSIC_USB_OTG_HS_HWHOST_ADDR A:0x678d9008
y.create.l HWIO_USB2_HSIC_USB_OTG_HS_HWDEVICE_ADDR A:0x678d900c
y.create.l HWIO_USB2_HSIC_USB_OTG_HS_HWTXBUF_ADDR A:0x678d9010
y.create.l HWIO_USB2_HSIC_USB_OTG_HS_HWRXBUF_ADDR A:0x678d9014
y.create.l HWIO_USB2_HSIC_USB_OTG_HS_SCRATCH_RAM0_ADDR A:0x678d9040
y.create.l HWIO_USB2_HSIC_USB_OTG_HS_SCRATCH_RAM1_ADDR A:0x678d9044
y.create.l HWIO_USB2_HSIC_USB_OTG_HS_SCRATCH_RAM2_ADDR A:0x678d9048
y.create.l HWIO_USB2_HSIC_USB_OTG_HS_SCRATCH_RAM3_ADDR A:0x678d904c
y.create.l HWIO_USB2_HSIC_USB_OTG_HS_SCRATCH_RAM4_ADDR A:0x678d9050
y.create.l HWIO_USB2_HSIC_USB_OTG_HS_SCRATCH_RAM5_ADDR A:0x678d9054
y.create.l HWIO_USB2_HSIC_USB_OTG_HS_SCRATCH_RAM6_ADDR A:0x678d9058
y.create.l HWIO_USB2_HSIC_USB_OTG_HS_SCRATCH_RAM7_ADDR A:0x678d905c
y.create.l HWIO_USB2_HSIC_USB_OTG_HS_SCRATCH_RAM8_ADDR A:0x678d9060
y.create.l HWIO_USB2_HSIC_USB_OTG_HS_SCRATCH_RAM9_ADDR A:0x678d9064
y.create.l HWIO_USB2_HSIC_USB_OTG_HS_GPTIMER0LD_ADDR A:0x678d9080
y.create.l HWIO_USB2_HSIC_USB_OTG_HS_GPTIMER0CTRL_ADDR A:0x678d9084
y.create.l HWIO_USB2_HSIC_USB_OTG_HS_GPTIMER1LD_ADDR A:0x678d9088
y.create.l HWIO_USB2_HSIC_USB_OTG_HS_GPTIMER1CTRL_ADDR A:0x678d908c
y.create.l HWIO_USB2_HSIC_USB_OTG_HS_AHB_BURST_ADDR A:0x678d9090
y.create.l HWIO_USB2_HSIC_USB_OTG_HS_XTOR_STS_ADDR A:0x678d9094
y.create.l HWIO_USB2_HSIC_USB_OTG_HS_AHB_MODE_ADDR A:0x678d9098
y.create.l HWIO_USB2_HSIC_USB_OTG_HS_GEN_CONFIG_ADDR A:0x678d909c
y.create.l HWIO_USB2_HSIC_USB_OTG_HS_GEN_CONFIG_2_ADDR A:0x678d90a0
y.create.l HWIO_USB2_HSIC_USB_OTG_HS_CAPLENGTH_ADDR A:0x678d9100
y.create.l HWIO_USB2_HSIC_USB_OTG_HS_HCSPARAMS_ADDR A:0x678d9104
y.create.l HWIO_USB2_HSIC_USB_OTG_HS_HCCPARAMS_ADDR A:0x678d9108
y.create.l HWIO_USB2_HSIC_USB_OTG_HS_DCIVERSION_ADDR A:0x678d9120
y.create.l HWIO_USB2_HSIC_USB_OTG_HS_DCCPARAMS_ADDR A:0x678d9124
y.create.l HWIO_USB2_HSIC_USB_OTG_HS_USBCMD_ADDR A:0x678d9140
y.create.l HWIO_USB2_HSIC_USB_OTG_HS_USBSTS_ADDR A:0x678d9144
y.create.l HWIO_USB2_HSIC_USB_OTG_HS_USBINTR_ADDR A:0x678d9148
y.create.l HWIO_USB2_HSIC_USB_OTG_HS_FRINDEX_ADDR A:0x678d914c
y.create.l HWIO_USB2_HSIC_USB_OTG_HS_PERIODICLISTBASE_ADDR A:0x678d9154
y.create.l HWIO_USB2_HSIC_USB_OTG_HS_DEVICEADDR_ADDR A:0x678d9154
y.create.l HWIO_USB2_HSIC_USB_OTG_HS_ASYNCLISTADDR_ADDR A:0x678d9158
y.create.l HWIO_USB2_HSIC_USB_OTG_HS_ENDPOINTLISTADDR_ADDR A:0x678d9158
y.create.l HWIO_USB2_HSIC_USB_OTG_HS_TTCTRL_ADDR A:0x678d915c
y.create.l HWIO_USB2_HSIC_USB_OTG_HS_BURSTSIZE_ADDR A:0x678d9160
y.create.l HWIO_USB2_HSIC_USB_OTG_HS_TXFILLTUNING_ADDR A:0x678d9164
y.create.l HWIO_USB2_HSIC_USB_OTG_HS_ULPI_VIEWPORT_ADDR A:0x678d9170
y.create.l HWIO_USB2_HSIC_USB_OTG_HS_ENDPTNAK_ADDR A:0x678d9178
y.create.l HWIO_USB2_HSIC_USB_OTG_HS_ENDPTNAKEN_ADDR A:0x678d917c
y.create.l HWIO_USB2_HSIC_USB_OTG_HS_PORTSC_ADDR A:0x678d9184
y.create.l HWIO_USB2_HSIC_USB_OTG_HS_OTGSC_ADDR A:0x678d91a4
y.create.l HWIO_USB2_HSIC_USB_OTG_HS_USBMODE_ADDR A:0x678d91a8
y.create.l HWIO_USB2_HSIC_USB_OTG_HS_ENDPTSETUPSTAT_ADDR A:0x678d91ac
y.create.l HWIO_USB2_HSIC_USB_OTG_HS_ENDPTPRIME_ADDR A:0x678d91b0
y.create.l HWIO_USB2_HSIC_USB_OTG_HS_ENDPTFLUSH_ADDR A:0x678d91b4
y.create.l HWIO_USB2_HSIC_USB_OTG_HS_ENDPTSTAT_ADDR A:0x678d91b8
y.create.l HWIO_USB2_HSIC_USB_OTG_HS_ENDPTCOMPLETE_ADDR A:0x678d91bc
y.create.l HWIO_USB2_HSIC_USB_OTG_HS_ENDPTCTRL0_ADDR A:0x678d91c0
y.create.l HWIO_USB2_HSIC_USB_OTG_HS_ENDPTCTRL1_ADDR A:0x678d91c4
y.create.l HWIO_USB2_HSIC_USB_OTG_HS_ENDPTCTRL2_ADDR A:0x678d91c8
y.create.l HWIO_USB2_HSIC_USB_OTG_HS_ENDPTCTRL3_ADDR A:0x678d91cc
y.create.l HWIO_USB2_HSIC_USB_OTG_HS_ENDPTCTRL4_ADDR A:0x678d91d0
y.create.l HWIO_USB2_HSIC_USB_OTG_HS_ENDPTCTRL5_ADDR A:0x678d91d4
y.create.l HWIO_USB2_HSIC_USB_OTG_HS_ENDPTCTRL6_ADDR A:0x678d91d8
y.create.l HWIO_USB2_HSIC_USB_OTG_HS_ENDPTCTRL7_ADDR A:0x678d91dc
y.create.l HWIO_USB2_HSIC_USB_OTG_HS_ENDPTCTRL8_ADDR A:0x678d91e0
y.create.l HWIO_USB2_HSIC_USB_OTG_HS_ENDPTCTRL9_ADDR A:0x678d91e4
y.create.l HWIO_USB2_HSIC_USB_OTG_HS_ENDPTCTRL10_ADDR A:0x678d91e8
y.create.l HWIO_USB2_HSIC_USB_OTG_HS_ENDPT_PIPE_ID1_ADDR A:0x678d9200
y.create.l HWIO_USB2_HSIC_USB_OTG_HS_ENDPT_PIPE_ID2_ADDR A:0x678d9204
y.create.l HWIO_USB2_HSIC_USB_OTG_HS_ENDPT_PIPE_ID3_ADDR A:0x678d9208
y.create.l HWIO_USB2_HSIC_USB_OTG_HS_ENDPT_PIPE_ID4_ADDR A:0x678d920c
y.create.l HWIO_USB2_HSIC_USB_OTG_HS_ENDPT_PIPE_ID5_ADDR A:0x678d9210
y.create.l HWIO_USB2_HSIC_USB_OTG_HS_ENDPT_PIPE_ID6_ADDR A:0x678d9214
y.create.l HWIO_USB2_HSIC_USB_OTG_HS_ENDPT_PIPE_ID7_ADDR A:0x678d9218
y.create.l HWIO_USB2_HSIC_USB_OTG_HS_ENDPT_PIPE_ID8_ADDR A:0x678d921c
y.create.l HWIO_USB2_HSIC_USB_OTG_HS_ENDPT_PIPE_ID9_ADDR A:0x678d9220
y.create.l HWIO_USB2_HSIC_USB_OTG_HS_ENDPT_PIPE_ID10_ADDR A:0x678d9224
y.create.l HWIO_USB2_HSIC_USB_OTG_HS_PHY_CTRL_ADDR A:0x678d9240
y.create.l HWIO_USB2_HSIC_USB_OTG_HS_GENERIC1_ADDR A:0x678d9244
y.create.l HWIO_USB2_HSIC_USB_OTG_HS_GENERIC2_ADDR A:0x678d9248
y.create.l HWIO_USB2_HSIC_USB_OTG_HS_L1_EP_CTRL_ADDR A:0x678d9250
y.create.l HWIO_USB2_HSIC_USB_OTG_HS_L1_CONFIG_ADDR A:0x678d9254
y.create.l HWIO_USB2_HSIC_USB_OTG_HS_LPM_DEBUG_1_ADDR A:0x678d9258
y.create.l HWIO_USB2_HSIC_USB_OTG_HS_LPM_DEBUG_2_ADDR A:0x678d925c
y.create.l HWIO_USB2_HSIC_USB_OTG_HS_LPM_ATTRIBUTES_ADDR A:0x678d9260
y.create.l HWIO_USB2_HSIC_USB_OTG_HS_LPM_TIMERS_ADDR A:0x678d9264
y.create.l HWIO_USB2_HSIC_USB_OTG_HS_HW_VER_ADDR A:0x678d9270
y.create.l HWIO_USB2_HSIC_USB_OTG_HS_TEST_BUS_ADDR A:0x678d9274
y.create.l HWIO_USB2_HSIC_USB_OTG_HS_PHY_SEC_CTRL_ADDR A:0x678d9278
y.create.l HWIO_USB2_HSIC_USB_OTG_HS_BTO_TIME_HS_ADDR A:0x678d9340
y.create.l HWIO_USB2_HSIC_USB_OTG_HS_BTO_TIME_FS_LS_ADDR A:0x678d9344
y.create.l HWIO_USB2_HSIC_USB_OTG_HS_QSB_VALUES_ADDR A:0x678d9348
y.create.l HWIO_USB2_HSIC_USB_OTG_HS_BAM_CTRL_ADDR A:0x678c4000
y.create.l HWIO_USB2_HSIC_USB_OTG_HS_BAM_TIMER_ADDR A:0x678c4040
y.create.l HWIO_USB2_HSIC_USB_OTG_HS_BAM_TIMER_CTRL_ADDR A:0x678c4044
y.create.l HWIO_USB2_HSIC_USB_OTG_HS_BAM_DESC_CNT_TRSHLD_ADDR A:0x678c4008
y.create.l HWIO_USB2_HSIC_USB_OTG_HS_BAM_IRQ_STTS_ADDR A:0x678c4014
y.create.l HWIO_USB2_HSIC_USB_OTG_HS_BAM_IRQ_CLR_ADDR A:0x678c4018
y.create.l HWIO_USB2_HSIC_USB_OTG_HS_BAM_IRQ_EN_ADDR A:0x678c401c
y.create.l HWIO_USB2_HSIC_USB_OTG_HS_BAM_CNFG_BITS_ADDR A:0x678c407c
y.create.l HWIO_USB2_HSIC_USB_OTG_HS_BAM_REVISION_ADDR A:0x678c5000
y.create.l HWIO_USB2_HSIC_USB_OTG_HS_BAM_SW_VERSION_ADDR A:0x678c5004
y.create.l HWIO_USB2_HSIC_USB_OTG_HS_BAM_NUM_PIPES_ADDR A:0x678c5008
y.create.l HWIO_USB2_HSIC_USB_OTG_HS_BAM_TEST_BUS_SEL_ADDR A:0x678c5010
y.create.l HWIO_USB2_HSIC_USB_OTG_HS_BAM_TEST_BUS_REG_ADDR A:0x678c5014
y.create.l HWIO_USB2_HSIC_USB_OTG_HS_BAM_AHB_MASTER_ERR_CTRLS_ADDR A:0x678c5024
y.create.l HWIO_USB2_HSIC_USB_OTG_HS_BAM_AHB_MASTER_ERR_ADDR_ADDR A:0x678c5028
y.create.l HWIO_USB2_HSIC_USB_OTG_HS_BAM_AHB_MASTER_ERR_DATA_ADDR A:0x678c502c
y.create.l HWIO_USB2_HSIC_USB_OTG_HS_BAM_AHB_MASTER_ERR_ADDR_LSB_ADDR A:0x678c5100
y.create.l HWIO_USB2_HSIC_USB_OTG_HS_BAM_AHB_MASTER_ERR_ADDR_MSB_ADDR A:0x678c5104
y.create.l HWIO_USB2_HSIC_USB_OTG_HS_BAM_TRUST_REG_ADDR A:0x678c6000
y.create.l HWIO_USB2_HSIC_USB_OTG_HS_BAM_P_TRUST_REG0_ADDR A:0x678c6020
y.create.l HWIO_USB2_HSIC_USB_OTG_HS_BAM_P_TRUST_REG1_ADDR A:0x678c6024
y.create.l HWIO_USB2_HSIC_USB_OTG_HS_BAM_IRQ_SRCS_EE0_ADDR A:0x678c7000
y.create.l HWIO_USB2_HSIC_USB_OTG_HS_BAM_IRQ_SRCS_EE1_ADDR A:0x678c8000
y.create.l HWIO_USB2_HSIC_USB_OTG_HS_BAM_IRQ_SRCS_EE2_ADDR A:0x678c9000
y.create.l HWIO_USB2_HSIC_USB_OTG_HS_BAM_IRQ_SRCS_EE3_ADDR A:0x678ca000
y.create.l HWIO_USB2_HSIC_USB_OTG_HS_BAM_IRQ_SRCS_EE4_ADDR A:0x678cb000
y.create.l HWIO_USB2_HSIC_USB_OTG_HS_BAM_IRQ_SRCS_EE5_ADDR A:0x678cc000
y.create.l HWIO_USB2_HSIC_USB_OTG_HS_BAM_IRQ_SRCS_EE6_ADDR A:0x678cd000
y.create.l HWIO_USB2_HSIC_USB_OTG_HS_BAM_IRQ_SRCS_EE7_ADDR A:0x678ce000
y.create.l HWIO_USB2_HSIC_USB_OTG_HS_BAM_IRQ_SRCS_MSK_EE0_ADDR A:0x678c7004
y.create.l HWIO_USB2_HSIC_USB_OTG_HS_BAM_IRQ_SRCS_MSK_EE1_ADDR A:0x678c8004
y.create.l HWIO_USB2_HSIC_USB_OTG_HS_BAM_IRQ_SRCS_MSK_EE2_ADDR A:0x678c9004
y.create.l HWIO_USB2_HSIC_USB_OTG_HS_BAM_IRQ_SRCS_MSK_EE3_ADDR A:0x678ca004
y.create.l HWIO_USB2_HSIC_USB_OTG_HS_BAM_IRQ_SRCS_MSK_EE4_ADDR A:0x678cb004
y.create.l HWIO_USB2_HSIC_USB_OTG_HS_BAM_IRQ_SRCS_MSK_EE5_ADDR A:0x678cc004
y.create.l HWIO_USB2_HSIC_USB_OTG_HS_BAM_IRQ_SRCS_MSK_EE6_ADDR A:0x678cd004
y.create.l HWIO_USB2_HSIC_USB_OTG_HS_BAM_IRQ_SRCS_MSK_EE7_ADDR A:0x678ce004
y.create.l HWIO_USB2_HSIC_USB_OTG_HS_BAM_IRQ_SRCS_UNMASKED_EE0_ADDR A:0x678c7008
y.create.l HWIO_USB2_HSIC_USB_OTG_HS_BAM_IRQ_SRCS_UNMASKED_EE1_ADDR A:0x678c8008
y.create.l HWIO_USB2_HSIC_USB_OTG_HS_BAM_IRQ_SRCS_UNMASKED_EE2_ADDR A:0x678c9008
y.create.l HWIO_USB2_HSIC_USB_OTG_HS_BAM_IRQ_SRCS_UNMASKED_EE3_ADDR A:0x678ca008
y.create.l HWIO_USB2_HSIC_USB_OTG_HS_BAM_IRQ_SRCS_UNMASKED_EE4_ADDR A:0x678cb008
y.create.l HWIO_USB2_HSIC_USB_OTG_HS_BAM_IRQ_SRCS_UNMASKED_EE5_ADDR A:0x678cc008
y.create.l HWIO_USB2_HSIC_USB_OTG_HS_BAM_IRQ_SRCS_UNMASKED_EE6_ADDR A:0x678cd008
y.create.l HWIO_USB2_HSIC_USB_OTG_HS_BAM_IRQ_SRCS_UNMASKED_EE7_ADDR A:0x678ce008
y.create.l HWIO_USB2_HSIC_USB_OTG_HS_BAM_PIPE_ATTR_EE0_ADDR A:0x678c700c
y.create.l HWIO_USB2_HSIC_USB_OTG_HS_BAM_PIPE_ATTR_EE1_ADDR A:0x678c800c
y.create.l HWIO_USB2_HSIC_USB_OTG_HS_BAM_PIPE_ATTR_EE2_ADDR A:0x678c900c
y.create.l HWIO_USB2_HSIC_USB_OTG_HS_BAM_PIPE_ATTR_EE3_ADDR A:0x678ca00c
y.create.l HWIO_USB2_HSIC_USB_OTG_HS_BAM_PIPE_ATTR_EE4_ADDR A:0x678cb00c
y.create.l HWIO_USB2_HSIC_USB_OTG_HS_BAM_PIPE_ATTR_EE5_ADDR A:0x678cc00c
y.create.l HWIO_USB2_HSIC_USB_OTG_HS_BAM_PIPE_ATTR_EE6_ADDR A:0x678cd00c
y.create.l HWIO_USB2_HSIC_USB_OTG_HS_BAM_PIPE_ATTR_EE7_ADDR A:0x678ce00c
y.create.l HWIO_USB2_HSIC_USB_OTG_HS_BAM_IRQ_SRCS_ADDR A:0x678c7010
y.create.l HWIO_USB2_HSIC_USB_OTG_HS_BAM_IRQ_SRCS_MSK_ADDR A:0x678c7014
y.create.l HWIO_USB2_HSIC_USB_OTG_HS_BAM_IRQ_SRCS_UNMASKED_ADDR A:0x678c7018
y.create.l HWIO_USB2_HSIC_USB_OTG_HS_BAM_P_CTRL0_ADDR A:0x678d7000
y.create.l HWIO_USB2_HSIC_USB_OTG_HS_BAM_P_CTRL1_ADDR A:0x678d8000
y.create.l HWIO_USB2_HSIC_USB_OTG_HS_BAM_P_RST0_ADDR A:0x678d7004
y.create.l HWIO_USB2_HSIC_USB_OTG_HS_BAM_P_RST1_ADDR A:0x678d8004
y.create.l HWIO_USB2_HSIC_USB_OTG_HS_BAM_P_HALT0_ADDR A:0x678d7008
y.create.l HWIO_USB2_HSIC_USB_OTG_HS_BAM_P_HALT1_ADDR A:0x678d8008
y.create.l HWIO_USB2_HSIC_USB_OTG_HS_BAM_P_IRQ_STTS0_ADDR A:0x678d7010
y.create.l HWIO_USB2_HSIC_USB_OTG_HS_BAM_P_IRQ_STTS1_ADDR A:0x678d8010
y.create.l HWIO_USB2_HSIC_USB_OTG_HS_BAM_P_IRQ_CLR0_ADDR A:0x678d7014
y.create.l HWIO_USB2_HSIC_USB_OTG_HS_BAM_P_IRQ_CLR1_ADDR A:0x678d8014
y.create.l HWIO_USB2_HSIC_USB_OTG_HS_BAM_P_IRQ_EN0_ADDR A:0x678d7018
y.create.l HWIO_USB2_HSIC_USB_OTG_HS_BAM_P_IRQ_EN1_ADDR A:0x678d8018
y.create.l HWIO_USB2_HSIC_USB_OTG_HS_BAM_P_TIMER0_ADDR A:0x678d701c
y.create.l HWIO_USB2_HSIC_USB_OTG_HS_BAM_P_TIMER1_ADDR A:0x678d801c
y.create.l HWIO_USB2_HSIC_USB_OTG_HS_BAM_P_TIMER_CTRL0_ADDR A:0x678d7020
y.create.l HWIO_USB2_HSIC_USB_OTG_HS_BAM_P_TIMER_CTRL1_ADDR A:0x678d8020
y.create.l HWIO_USB2_HSIC_USB_OTG_HS_BAM_P_PRDCR_SDBND0_ADDR A:0x678d7024
y.create.l HWIO_USB2_HSIC_USB_OTG_HS_BAM_P_PRDCR_SDBND1_ADDR A:0x678d8024
y.create.l HWIO_USB2_HSIC_USB_OTG_HS_BAM_P_CNSMR_SDBND0_ADDR A:0x678d7028
y.create.l HWIO_USB2_HSIC_USB_OTG_HS_BAM_P_CNSMR_SDBND1_ADDR A:0x678d8028
y.create.l HWIO_USB2_HSIC_USB_OTG_HS_BAM_P_SW_OFSTS0_ADDR A:0x678d7800
y.create.l HWIO_USB2_HSIC_USB_OTG_HS_BAM_P_SW_OFSTS1_ADDR A:0x678d8800
y.create.l HWIO_USB2_HSIC_USB_OTG_HS_BAM_P_AU_PSM_CNTXT_1_0_ADDR A:0x678d7804
y.create.l HWIO_USB2_HSIC_USB_OTG_HS_BAM_P_AU_PSM_CNTXT_1_1_ADDR A:0x678d8804
y.create.l HWIO_USB2_HSIC_USB_OTG_HS_BAM_P_PSM_CNTXT_2_0_ADDR A:0x678d7808
y.create.l HWIO_USB2_HSIC_USB_OTG_HS_BAM_P_PSM_CNTXT_2_1_ADDR A:0x678d8808
y.create.l HWIO_USB2_HSIC_USB_OTG_HS_BAM_P_PSM_CNTXT_3_0_ADDR A:0x678d780c
y.create.l HWIO_USB2_HSIC_USB_OTG_HS_BAM_P_PSM_CNTXT_3_1_ADDR A:0x678d880c
y.create.l HWIO_USB2_HSIC_USB_OTG_HS_BAM_P_PSM_CNTXT_4_0_ADDR A:0x678d7810
y.create.l HWIO_USB2_HSIC_USB_OTG_HS_BAM_P_PSM_CNTXT_4_1_ADDR A:0x678d8810
y.create.l HWIO_USB2_HSIC_USB_OTG_HS_BAM_P_PSM_CNTXT_5_0_ADDR A:0x678d7814
y.create.l HWIO_USB2_HSIC_USB_OTG_HS_BAM_P_PSM_CNTXT_5_1_ADDR A:0x678d8814
y.create.l HWIO_USB2_HSIC_USB_OTG_HS_BAM_P_EVNT_REG0_ADDR A:0x678d7818
y.create.l HWIO_USB2_HSIC_USB_OTG_HS_BAM_P_EVNT_REG1_ADDR A:0x678d8818
y.create.l HWIO_USB2_HSIC_USB_OTG_HS_BAM_P_DESC_FIFO_ADDR0_ADDR A:0x678d781c
y.create.l HWIO_USB2_HSIC_USB_OTG_HS_BAM_P_DESC_FIFO_ADDR1_ADDR A:0x678d881c
y.create.l HWIO_USB2_HSIC_USB_OTG_HS_BAM_P_FIFO_SIZES0_ADDR A:0x678d7820
y.create.l HWIO_USB2_HSIC_USB_OTG_HS_BAM_P_FIFO_SIZES1_ADDR A:0x678d8820
y.create.l HWIO_USB2_HSIC_USB_OTG_HS_BAM_P_DATA_FIFO_ADDR0_ADDR A:0x678d7824
y.create.l HWIO_USB2_HSIC_USB_OTG_HS_BAM_P_DATA_FIFO_ADDR1_ADDR A:0x678d8824
y.create.l HWIO_USB2_HSIC_USB_OTG_HS_BAM_P_EVNT_GEN_TRSHLD0_ADDR A:0x678d7828
y.create.l HWIO_USB2_HSIC_USB_OTG_HS_BAM_P_EVNT_GEN_TRSHLD1_ADDR A:0x678d8828
y.create.l HWIO_USB2_HSIC_USB_OTG_HS_BAM_P_EVNT_DEST_ADDR0_ADDR A:0x678d782c
y.create.l HWIO_USB2_HSIC_USB_OTG_HS_BAM_P_EVNT_DEST_ADDR1_ADDR A:0x678d882c
y.create.l HWIO_USB2_HSIC_USB_OTG_HS_BAM_P_DF_CNTXT_0_ADDR A:0x678d7830
y.create.l HWIO_USB2_HSIC_USB_OTG_HS_BAM_P_DF_CNTXT_1_ADDR A:0x678d8830
y.create.l HWIO_USB2_HSIC_USB_OTG_HS_BAM_P_RETR_CNTXT_0_ADDR A:0x678d7834
y.create.l HWIO_USB2_HSIC_USB_OTG_HS_BAM_P_RETR_CNTXT_1_ADDR A:0x678d8834
y.create.l HWIO_USB2_HSIC_USB_OTG_HS_BAM_P_SI_CNTXT_0_ADDR A:0x678d7838
y.create.l HWIO_USB2_HSIC_USB_OTG_HS_BAM_P_SI_CNTXT_1_ADDR A:0x678d8838
y.create.l HWIO_USB2_HSIC_USB_OTG_HS_BAM_P_PSM_CNTXT_3_LSB0_ADDR A:0x678d7900
y.create.l HWIO_USB2_HSIC_USB_OTG_HS_BAM_P_PSM_CNTXT_3_LSB1_ADDR A:0x678d8900
y.create.l HWIO_USB2_HSIC_USB_OTG_HS_BAM_P_PSM_CNTXT_3_MSB0_ADDR A:0x678d7904
y.create.l HWIO_USB2_HSIC_USB_OTG_HS_BAM_P_PSM_CNTXT_3_MSB1_ADDR A:0x678d8904
y.create.l HWIO_USB2_HSIC_USB_OTG_HS_BAM_P_DESC_FIFO_ADDR_LSB0_ADDR A:0x678d7910
y.create.l HWIO_USB2_HSIC_USB_OTG_HS_BAM_P_DESC_FIFO_ADDR_LSB1_ADDR A:0x678d8910
y.create.l HWIO_USB2_HSIC_USB_OTG_HS_BAM_P_DESC_FIFO_ADDR_MSB0_ADDR A:0x678d7914
y.create.l HWIO_USB2_HSIC_USB_OTG_HS_BAM_P_DESC_FIFO_ADDR_MSB1_ADDR A:0x678d8914
y.create.l HWIO_USB2_HSIC_USB_OTG_HS_BAM_P_DATA_FIFO_ADDR_LSB0_ADDR A:0x678d7920
y.create.l HWIO_USB2_HSIC_USB_OTG_HS_BAM_P_DATA_FIFO_ADDR_LSB1_ADDR A:0x678d8920
y.create.l HWIO_USB2_HSIC_USB_OTG_HS_BAM_P_DATA_FIFO_ADDR_MSB0_ADDR A:0x678d7924
y.create.l HWIO_USB2_HSIC_USB_OTG_HS_BAM_P_DATA_FIFO_ADDR_MSB1_ADDR A:0x678d8924
y.create.l HWIO_USB2_HSIC_USB_OTG_HS_BAM_P_EVNT_DEST_ADDR_LSB0_ADDR A:0x678d7930
y.create.l HWIO_USB2_HSIC_USB_OTG_HS_BAM_P_EVNT_DEST_ADDR_LSB1_ADDR A:0x678d8930
y.create.l HWIO_USB2_HSIC_USB_OTG_HS_BAM_P_EVNT_DEST_ADDR_MSB0_ADDR A:0x678d7934
y.create.l HWIO_USB2_HSIC_USB_OTG_HS_BAM_P_EVNT_DEST_ADDR_MSB1_ADDR A:0x678d8934
y.create.l HWIO_USB2_PHY_USB_PHY_REVISION_ID0_ADDR A:0x6006c000
y.create.l HWIO_USB2_PHY_USB_PHY_REVISION_ID1_ADDR A:0x6006c004
y.create.l HWIO_USB2_PHY_USB_PHY_REVISION_ID2_ADDR A:0x6006c008
y.create.l HWIO_USB2_PHY_USB_PHY_REVISION_ID3_ADDR A:0x6006c00c
y.create.l HWIO_USB2_PHY_USB_PHY_DEBUG_BUS_STAT0_ADDR A:0x6006c010
y.create.l HWIO_USB2_PHY_USB_PHY_DEBUG_BUS_STAT1_ADDR A:0x6006c014
y.create.l HWIO_USB2_PHY_USB_PHY_DEBUG_BUS_STAT2_ADDR A:0x6006c018
y.create.l HWIO_USB2_PHY_USB_PHY_DEBUG_BUS_STAT3_ADDR A:0x6006c01c
y.create.l HWIO_USB2_PHY_USB_PHY_HS_RX_TESTER_OUT_1_ADDR A:0x6006c020
y.create.l HWIO_USB2_PHY_USB_PHY_CHARGING_DET_OUTPUT_ADDR A:0x6006c024
y.create.l HWIO_USB2_PHY_USB_PHY_HS_PHY_IRQ_STAT_ADDR A:0x6006c028
y.create.l HWIO_USB2_PHY_USB_PHY_HS_PHY_TEST_OUT_1_ADDR A:0x6006c02c
y.create.l HWIO_USB2_PHY_USB_PHY_UTMI_VEC4_STATUS_ADDR A:0x6006c030
y.create.l HWIO_USB2_PHY_USB_PHY_ULPI_VEC0_STATUS_ADDR A:0x6006c034
y.create.l HWIO_USB2_PHY_USB_PHY_ULPI_VEC1_STATUS_ADDR A:0x6006c038
y.create.l HWIO_USB2_PHY_USB_PHY_INTERRUPT_STATUS0_ADDR A:0x6006c03c
y.create.l HWIO_USB2_PHY_USB_PHY_INTERRUPT_STATUS1_ADDR A:0x6006c040
y.create.l HWIO_USB2_PHY_USB_PHY_RX_CHK_ERR_CNT1_STATUS_ADDR A:0x6006c044
y.create.l HWIO_USB2_PHY_USB_PHY_RX_CHK_STATUS_ADDR A:0x6006c048
y.create.l HWIO_USB2_PHY_USB_PHY_REFCLK_RXTAP_TEST_STATUS_ADDR A:0x6006c04c
y.create.l HWIO_USB2_PHY_USB_PHY_UTMI_RX_DATAL_STATUS_ADDR A:0x6006c050
y.create.l HWIO_USB2_PHY_USB_PHY_UTMI_RX_DATAH_STATUS_ADDR A:0x6006c054
y.create.l HWIO_USB2_PHY_USB_PHY_UTMI_RX_PORT_STATUS_ADDR A:0x6006c058
y.create.l HWIO_USB2_PHY_USB_PHY_INTERRUPT_SRC_STATUS_ADDR A:0x6006c05c
y.create.l HWIO_USB2_PHY_USB_PHY_UTMI_CTRL0_ADDR A:0x6006c060
y.create.l HWIO_USB2_PHY_USB_PHY_UTMI_CTRL1_ADDR A:0x6006c064
y.create.l HWIO_USB2_PHY_USB_PHY_UTMI_CTRL2_ADDR A:0x6006c068
y.create.l HWIO_USB2_PHY_USB_PHY_UTMI_CTRL3_ADDR A:0x6006c06c
y.create.l HWIO_USB2_PHY_USB_PHY_UTMI_CTRL4_ADDR A:0x6006c070
y.create.l HWIO_USB2_PHY_USB_PHY_UTMI_CTRL5_ADDR A:0x6006c074
y.create.l HWIO_USB2_PHY_USB_PHY_HS_PHY_CTRL_COMMON0_ADDR A:0x6006c078
y.create.l HWIO_USB2_PHY_USB_PHY_HS_PHY_CTRL_COMMON1_ADDR A:0x6006c07c
y.create.l HWIO_USB2_PHY_USB_PHY_HS_PHY_CTRL_COMMON2_ADDR A:0x6006c080
y.create.l HWIO_USB2_PHY_USB_PHY_HS_PHY_CTRL_COMMON3_ADDR A:0x6006c084
y.create.l HWIO_USB2_PHY_USB_PHY_HS_PHY_CTRL0_ADDR A:0x6006c088
y.create.l HWIO_USB2_PHY_USB_PHY_HS_PHY_CTRL1_ADDR A:0x6006c08c
y.create.l HWIO_USB2_PHY_USB_PHY_HS_PHY_CTRL2_ADDR A:0x6006c090
y.create.l HWIO_USB2_PHY_USB_PHY_HS_PHY_CTRL3_ADDR A:0x6006c094
y.create.l HWIO_USB2_PHY_USB_PHY_PARAMETER_OVERRIDE_X0_ADDR A:0x6006c098
y.create.l HWIO_USB2_PHY_USB_PHY_PARAMETER_OVERRIDE_X1_ADDR A:0x6006c09c
y.create.l HWIO_USB2_PHY_USB_PHY_PARAMETER_OVERRIDE_X2_ADDR A:0x6006c0a0
y.create.l HWIO_USB2_PHY_USB_PHY_PARAMETER_OVERRIDE_X3_ADDR A:0x6006c0a4
y.create.l HWIO_USB2_PHY_USB_PHY_CHARGING_DET_CTRL_ADDR A:0x6006c0a8
y.create.l HWIO_USB2_PHY_USB_PHY_HS_PHY_TEST0_ADDR A:0x6006c0ac
y.create.l HWIO_USB2_PHY_USB_PHY_HS_PHY_TEST1_ADDR A:0x6006c0b0
y.create.l HWIO_USB2_PHY_USB_PHY_HS_RX_TESTER_1_REG0_ADDR A:0x6006c0b4
y.create.l HWIO_USB2_PHY_USB_PHY_HS_RX_TESTER_1_REG1_ADDR A:0x6006c0b8
y.create.l HWIO_USB2_PHY_USB_PHY_HS_RX_TESTER_1_REG3_ADDR A:0x6006c0bc
y.create.l HWIO_USB2_PHY_USB_PHY_TCSR_CTRL_ADDR A:0x6006c0c0
y.create.l HWIO_USB2_PHY_USB_PHY_CFG0_ADDR A:0x6006c0c4
y.create.l HWIO_USB2_PHY_UTMI_PHY_CMN_CTRL0_ADDR A:0x6006c0c8
y.create.l HWIO_USB2_PHY_UTMI_PHY_CMN_CTRL1_ADDR A:0x6006c0cc
y.create.l HWIO_USB2_PHY_USB_PHY_IRQ_CMD_ADDR A:0x6006c0d0
y.create.l HWIO_USB2_PHY_USB_PHY_INTERRUPT_MASK0_ADDR A:0x6006c0d4
y.create.l HWIO_USB2_PHY_USB_PHY_INTERRUPT_MASK1_ADDR A:0x6006c0d8
y.create.l HWIO_USB2_PHY_USB_PHY_INTERRUPT_CLEAR0_ADDR A:0x6006c0dc
y.create.l HWIO_USB2_PHY_USB_PHY_INTERRUPT_CLEAR1_ADDR A:0x6006c0e0
y.create.l HWIO_USB2_PHY_USB_PHY_REFCLK_CTRL_ADDR A:0x6006c0e8
y.create.l HWIO_USB2_PHY_USB_PHY_PWRDOWN_CTRL_ADDR A:0x6006c0ec
y.create.l HWIO_USB2_PHY_USB_PHY_ULPI_OVERRIDE_7_0_ADDR A:0x6006c0f0
y.create.l HWIO_USB2_PHY_USB_PHY_ULPI_OVERRIDE_15_8_ADDR A:0x6006c0f4
y.create.l HWIO_USB2_PHY_USB_PHY_ULPI_OVERRIDE_23_16_ADDR A:0x6006c0f8
y.create.l HWIO_USB2_PHY_USB_PHY_ULPI_OVERRIDE_31_24_ADDR A:0x6006c0fc
y.create.l HWIO_USB2_PHY_USB_PHY_TEST_DEBUG_CTRL_ADDR A:0x6006c104
y.create.l HWIO_USB2_PHY_USB_PHY_RESET_CTRL_ADDR A:0x6006c108
y.create.l HWIO_VENUS0_VENUS_SS_ENC_INTR_STATUS_ADDR A:0x61d00000
y.create.l HWIO_VENUS0_VENUS_SS_ENC_INTR_MASK_ADDR A:0x61d00004
y.create.l HWIO_VENUS0_VENUS_SS_ENC_SPARE_0_ADDR A:0x61d00008
y.create.l HWIO_VENUS0_VENUS_SS_ENC_CLOCK_HALT_ADDR A:0x61d0000c
y.create.l HWIO_VENUS0_VENUS_SS_ENC_SPARE_1_ADDR A:0x61d00010
y.create.l HWIO_VENUS0_VENUS_SS_ENC_WDLOAD0_ADDR A:0x61d00014
y.create.l HWIO_VENUS0_VENUS_SS_ENC_WDLOAD1_ADDR A:0x61d00018
y.create.l HWIO_VENUS0_VENUS_SS_ENC_WDLOAD2_ADDR A:0x61d0001c
y.create.l HWIO_VENUS0_VENUS_SS_ENC_WDVALUE0_ADDR A:0x61d00020
y.create.l HWIO_VENUS0_VENUS_SS_ENC_WDVALUE1_ADDR A:0x61d00024
y.create.l HWIO_VENUS0_VENUS_SS_ENC_WDVALUE2_ADDR A:0x61d00028
y.create.l HWIO_VENUS0_VENUS_SS_ENC_WD_IRQ_STATUS_ADDR A:0x61d0002c
y.create.l HWIO_VENUS0_VENUS_SS_ENC_WD_IRQ_MASK_ADDR A:0x61d00030
y.create.l HWIO_VENUS0_VENUS_SS_ENC_WD_IRQ_CLEAR_ADDR A:0x61d00034
y.create.l HWIO_VENUS0_VENUS_SS_ENC_CLOCK_EN_ADDR A:0x61d00038
y.create.l HWIO_VENUS0_VENUS_SS_ENC_SW_RESET_ADDR A:0x61d0003c
y.create.l HWIO_VENUS0_VENUS_SS_ENC_SPARE_2_ADDR A:0x61d00040
y.create.l HWIO_VENUS0_VENUS_VSP_TOP_ENC_STATUS_ADDR A:0x61d01000
y.create.l HWIO_VENUS0_VENUS_VSP_TOP_ENC_MASK_ADDR A:0x61d01004
y.create.l HWIO_VENUS0_VENUS_VSP_TOP_ENC_SPARE_0_ADDR A:0x61d01008
y.create.l HWIO_VENUS0_VENUS_VSP_TOP_ENC_SPARE_1_ADDR A:0x61d0100c
y.create.l HWIO_VENUS0_VENUS_VSP_TOP_ENC_SPARE_2_ADDR A:0x61d01010
y.create.l HWIO_VENUS0_VENUS_VSP_TOP_ENC_SDE_CP_STATUS_ADDR A:0x61d01014
y.create.l HWIO_VENUS0_VENUS_VSP_CCE_ENC_CMD_ADDR A:0x61d02000
y.create.l HWIO_VENUS0_VENUS_VSP_CCE_ENC_RESULT_ADDR A:0x61d02004
y.create.l HWIO_VENUS0_VENUS_VSP_CCE_ENC_CP_CODEC_CONFIG_ADDR A:0x61d02028
y.create.l HWIO_VENUS0_VENUS_VSP_CCE_ENC_CP_DMA_RD_OFFSET_ADDR A:0x61d0202c
y.create.l HWIO_VENUS0_VENUS_VSP_CCE_ENC_CP_DMA_WR_OFFSET_ADDR A:0x61d02030
y.create.l HWIO_VENUS0_VENUS_VSP_CCE_ENC_CP_DMA_SIZE_ADDR A:0x61d02034
y.create.l HWIO_VENUS0_VENUS_VSP_CCE_ENC_FIFO_STATUS_ADDR A:0x61d02038
y.create.l HWIO_VENUS0_VENUS_VSP_CCE_ENC_CMD_STATUS_ADDR A:0x61d0203c
y.create.l HWIO_VENUS0_VENUS_VSP_CCE_ENC_CMD_STATUS_CLEAR_ADDR A:0x61d02040
y.create.l HWIO_VENUS0_VENUS_VSP_CCE_ENC_CMD_IRQ_MASK_ADDR A:0x61d02044
y.create.l HWIO_VENUS0_VENUS_VSP_CCE_ENC_CMD_RSLT_QUEUE_TIMEOUT_CFG_ADDR A:0x61d02048
y.create.l HWIO_VENUS0_VENUS_VSP_CCE_ENC_CMD_TEST_BUS_CONTROL_ADDR A:0x61d0204c
y.create.l HWIO_VENUS0_VENUS_VSP_CCE_ENC_CMD_TEST_BUS_REGISTER_ADDR A:0x61d02050
y.create.l HWIO_VENUS0_VENUS_VSP_CCE_ENC_SW_RESET_ADDR A:0x61d02054
y.create.l HWIO_VENUS0_VENUS_VSP_CCE_ENC_SPARE_0_ADDR A:0x61d02058
y.create.l HWIO_VENUS0_VENUS_VSP_SDE_ENC_TOP_AP_START_ADDR A:0x61d03000
y.create.l HWIO_VENUS0_VENUS_VSP_SDE_ENC_TOP_AP_CONFIG_ADDR A:0x61d03004
y.create.l HWIO_VENUS0_VENUS_VSP_SDE_ENC_TOP_AP_SIZE_ADDR A:0x61d03008
y.create.l HWIO_VENUS0_VENUS_VSP_SDE_ENC_TOP_CODEC_CONFIG_ADDR A:0x61d0300c
y.create.l HWIO_VENUS0_VENUS_VSP_SDE_ENC_TOP_SW_RESET_ADDR A:0x61d03010
y.create.l HWIO_VENUS0_VENUS_VSP_SDE_ENC_ENC_CFG_ADDR A:0x61d03014
y.create.l HWIO_VENUS0_VENUS_VSP_SDE_ENC_BIT_BUF_WR_OFFSET_STATUS_ADDR A:0x61d03018
y.create.l HWIO_VENUS0_VENUS_VSP_SDE_ENC_BIT_BUF_WR_OFFSET_ADDR A:0x61d0301c
y.create.l HWIO_VENUS0_VENUS_VSP_SDE_ENC_BIT_BUF_SIZE_ADDR A:0x61d03020
y.create.l HWIO_VENUS0_VENUS_VSP_SDE_ENC_BIT_BUF_WR_OFFSET2_ADDR A:0x61d03024
y.create.l HWIO_VENUS0_VENUS_VSP_SDE_ENC_BIT_BUF_SIZE2_ADDR A:0x61d03028
y.create.l HWIO_VENUS0_VENUS_VSP_SDE_ENC_SLICE_INFO_BUF_WR_OFFSET_ADDR A:0x61d0302c
y.create.l HWIO_VENUS0_VENUS_VSP_SDE_ENC_SLICE_INFO_BUF_SIZE_ADDR A:0x61d03030
y.create.l HWIO_VENUS0_VENUS_VSP_SDE_ENC_BIN_BUF_RD_OFFSET0_ADDR A:0x61d03034
y.create.l HWIO_VENUS0_VENUS_VSP_SDE_ENC_BIN_BUF_RD_OFFSET1_ADDR A:0x61d03038
y.create.l HWIO_VENUS0_VENUS_VSP_SDE_ENC_BIN_BUF_RD_SIZE0_ADDR A:0x61d0303c
y.create.l HWIO_VENUS0_VENUS_VSP_SDE_ENC_BIN_BUF_RD_SIZE1_ADDR A:0x61d03040
y.create.l HWIO_VENUS0_VENUS_VSP_SDE_ENC_BIN_BUF_RD_BYTE_COUNT0_ADDR A:0x61d03044
y.create.l HWIO_VENUS0_VENUS_VSP_SDE_ENC_BIN_BUF_RD_BYTE_COUNT1_ADDR A:0x61d03048
y.create.l HWIO_VENUS0_VENUS_VSP_SDE_ENC_SLICE_BIT_COUNT_LIMIT_ADDR A:0x61d0304c
y.create.l HWIO_VENUS0_VENUS_VSP_SDE_ENC_LCU_POS_INFO_ADDR A:0x61d03050
y.create.l HWIO_VENUS0_VENUS_VSP_SDE_ENC_NUM_LCU_INFO_ADDR A:0x61d03054
y.create.l HWIO_VENUS0_VENUS_VSP_SDE_ENC_NUM_EPC_ADDR A:0x61d03058
y.create.l HWIO_VENUS0_VENUS_VSP_SDE_ENC_NUM_SLICE_ADDR A:0x61d0305c
y.create.l HWIO_VENUS0_VENUS_VSP_SDE_ENC_CUHDR_BITS_ADDR A:0x61d03060
y.create.l HWIO_VENUS0_VENUS_VSP_SDE_ENC_RESID_BITS_ADDR A:0x61d03064
y.create.l HWIO_VENUS0_VENUS_VSP_SDE_ENC_HEADER_BITS_ADDR A:0x61d03068
y.create.l HWIO_VENUS0_VENUS_VSP_SDE_ENC_IRQ_STATUS_ADDR A:0x61d0306c
y.create.l HWIO_VENUS0_VENUS_VSP_SDE_ENC_IRQ_CLEAR_ADDR A:0x61d03070
y.create.l HWIO_VENUS0_VENUS_VSP_SDE_ENC_IRQ_MASK_ADDR A:0x61d03074
y.create.l HWIO_VENUS0_VENUS_VSP_SDE_ENC_LC_PARAM_ADDR A:0x61d03078
y.create.l HWIO_VENUS0_VENUS_VSP_SDE_ENC_LC_STATUS_ADDR A:0x61d0307c
y.create.l HWIO_VENUS0_VENUS_VSP_SDE_ENC_SLICE_INFO_OFFSET_ADDR A:0x61d03080
y.create.l HWIO_VENUS0_VENUS_VSP_SDE_ENC_SLICE_INFO_SIZE_ADDR A:0x61d03084
y.create.l HWIO_VENUS0_VENUS_VSP_SDE_ENC_SLICE_INFO_FIFO_STATUS_ADDR A:0x61d03088
y.create.l HWIO_VENUS0_VENUS_VSP_SDE_ENC_TILE_INIT_ADDR A:0x61d0308c
y.create.l HWIO_VENUS0_VENUS_VSP_SDE_ENC_TILE_X_ADDR A:0x61d03090
y.create.l HWIO_VENUS0_VENUS_VSP_SDE_ENC_TILE_Y_ADDR A:0x61d03094
y.create.l HWIO_VENUS0_VENUS_VSP_SDE_ENC_TEST_BUS_CONTROL_ADDR A:0x61d03098
y.create.l HWIO_VENUS0_VENUS_VSP_SDE_ENC_TEST_BUS_REG_ADDR A:0x61d0309c
y.create.l HWIO_VENUS0_VENUS_VSP_SDE_ENC_TOP_SINGLE_STEP_CONTROL_ADDR A:0x61d030a0
y.create.l HWIO_VENUS0_VENUS_VSP_SDE_ENC_TOP_SPARE_ADDR A:0x61d030a4
y.create.l HWIO_VENUS0_VENUS_VSP_SDE_ENC_H265E_SLICE_CFG_ADDR A:0x61d030a8
y.create.l HWIO_VENUS0_VENUS_VSP_SDE_ENC_H265E_SLICE_CFG2_ADDR A:0x61d030ac
y.create.l HWIO_VENUS0_VENUS_VSP_SDE_ENC_H264E_SLICE_CFG_ADDR A:0x61d030b0
y.create.l HWIO_VENUS0_VENUS_VSP_SDE_ENC_VPXA_CTRL_ADDR A:0x61d030b4
y.create.l HWIO_VENUS0_VENUS_VSP_SDE_ENC_VPX_CFG_0_ADDR A:0x61d030b8
y.create.l HWIO_VENUS0_VENUS_VSP_SDE_ENC_VPXA_BOOL_VALUE_ADDR A:0x61d030bc
y.create.l HWIO_VENUS0_VENUS_VSP_SDE_ENC_VPXA_BOOL_PARAM_0_ADDR A:0x61d030c0
y.create.l HWIO_VENUS0_VENUS_VSP_SDE_ENC_FRM_BIT_RD_SIZE_ADDR A:0x61d030c4
y.create.l HWIO_VENUS0_VENUS_VSP_SDE_ENC_SEGMENT_PROB_ADDR A:0x61d030c8
y.create.l HWIO_VENUS0_VENUS_VSP_SDE_ENC_SEGMENT_TREE_PROB_0_ADDR A:0x61d030cc
y.create.l HWIO_VENUS0_VENUS_VSP_SDE_ENC_SEGMENT_TREE_PROB_1_ADDR A:0x61d030d0
y.create.l HWIO_VENUS0_VENUS_VSP_SDE_ENC_SPARE_0_ADDR A:0x61d030d4
y.create.l HWIO_VENUS0_VENUS_VPP_TOP_ENC_STATUS_ADDR A:0x61d04000
y.create.l HWIO_VENUS0_VENUS_VPP_TOP_ENC_MASK_ADDR A:0x61d04004
y.create.l HWIO_VENUS0_VENUS_VPP_TOP_ENC_SPARE_0_ADDR A:0x61d04008
y.create.l HWIO_VENUS0_VENUS_VPP_TOP_ME_STANDALONE_MODE_ADDR A:0x61d0400c
y.create.l HWIO_VENUS0_VENUS_VPP_TOP_START_ADDR A:0x61d04010
y.create.l HWIO_VENUS0_VENUS_VPP_TOP_ENC_SPARE_1_ADDR A:0x61d04014
y.create.l HWIO_VENUS0_VENUS_VPP_TOP_ENC_SE_CP_STATUS_ADDR A:0x61d04018
y.create.l HWIO_VENUS0_VENUS_VPP_SE_ENC_START_ADDR A:0x61d05000
y.create.l HWIO_VENUS0_VENUS_VPP_SE_ENC_TOP_CONFIG_ADDR A:0x61d05004
y.create.l HWIO_VENUS0_VENUS_VPP_SE_ENC_TOP_PIC_SIZE_IN_SAMPLES_ADDR A:0x61d05008
y.create.l HWIO_VENUS0_VENUS_VPP_SE_ENC_CFG_ADDR A:0x61d0500c
y.create.l HWIO_VENUS0_VENUS_VPP_SE_ENC_TILE_X_ADDR A:0x61d05010
y.create.l HWIO_VENUS0_VENUS_VPP_SE_ENC_TILE_Y_ADDR A:0x61d05014
y.create.l HWIO_VENUS0_VENUS_VPP_SE_ENC_SLICE_CFG_ADDR A:0x61d05018
y.create.l HWIO_VENUS0_VENUS_VPP_SE_ENC_SLICE_CFG2_ADDR A:0x61d0501c
y.create.l HWIO_VENUS0_VENUS_VPP_SE_ENC_MP4E_CFG_ADDR A:0x61d05020
y.create.l HWIO_VENUS0_VENUS_VPP_SE_ENC_H264E_VPXE_SLICE_CFG_ADDR A:0x61d05024
y.create.l HWIO_VENUS0_VENUS_VPP_SE_ENC_PACKER_CFG1_ADDR A:0x61d05028
y.create.l HWIO_VENUS0_VENUS_VPP_SE_ENC_PACKER_CFG2_ADDR A:0x61d0502c
y.create.l HWIO_VENUS0_VENUS_VPP_SE_ENC_MEM_ADDR_ADDR A:0x61d05030
y.create.l HWIO_VENUS0_VENUS_VPP_SE_ENC_MEM_DATA_ADDR A:0x61d05034
y.create.l HWIO_VENUS0_VENUS_VPP_SE_ENC_RSHDR_SE_ADDR_ADDR A:0x61d05038
y.create.l HWIO_VENUS0_VENUS_VPP_SE_ENC_DSHDR_SE_ADDR_ADDR A:0x61d0503c
y.create.l HWIO_VENUS0_VENUS_VPP_SE_ENC_FRHDR_SE_ADDR_ADDR A:0x61d05040
y.create.l HWIO_VENUS0_VENUS_VPP_SE_ENC_LCU_OVR_ADDR A:0x61d05044
y.create.l HWIO_VENUS0_VENUS_VPP_SE_ENC_SG_STATUS_ADDR A:0x61d05048
y.create.l HWIO_VENUS0_VENUS_VPP_SE_ENC_STATUS_CLEAR_ADDR A:0x61d0504c
y.create.l HWIO_VENUS0_VENUS_VPP_SE_ENC_IRQ_MASK_ADDR A:0x61d05050
y.create.l HWIO_VENUS0_VENUS_VPP_SE_ENC_LCU_POS_INFO_R0_ADDR A:0x61d05054
y.create.l HWIO_VENUS0_VENUS_VPP_SE_ENC_LCU_POS_INFO_R1_ADDR A:0x61d05058
y.create.l HWIO_VENUS0_VENUS_VPP_SE_ENC_CUHDR_BINS_ADDR A:0x61d0505c
y.create.l HWIO_VENUS0_VENUS_VPP_SE_ENC_RESID_BINS_ADDR A:0x61d05060
y.create.l HWIO_VENUS0_VENUS_VPP_SE_ENC_HEADER_BITS_ADDR A:0x61d05064
y.create.l HWIO_VENUS0_VENUS_VPP_SE_ENC_LCU_POS_INFO_ADDR A:0x61d05068
y.create.l HWIO_VENUS0_VENUS_VPP_SE_ENC_LC_PARAM_ADDR A:0x61d0506c
y.create.l HWIO_VENUS0_VENUS_VPP_SE_ENC_LC_STATUS_ADDR A:0x61d05070
y.create.l HWIO_VENUS0_VENUS_VPP_SE_ENC_TEST_BUS_CONTROL_ADDR A:0x61d05074
y.create.l HWIO_VENUS0_VENUS_VPP_SE_ENC_TEST_BUS_REG_ADDR A:0x61d05078
y.create.l HWIO_VENUS0_VENUS_VPP_SE_ENC_PACKER_STATUS1_ADDR A:0x61d0507c
y.create.l HWIO_VENUS0_VENUS_VPP_SE_ENC_PACKER_STATUS2_ADDR A:0x61d05080
y.create.l HWIO_VENUS0_VENUS_VPP_SE_ENC_PACKER_STATUS3_ADDR A:0x61d05084
y.create.l HWIO_VENUS0_VENUS_VPP_SE_ENC_PACKER_EXT0_OFFSET_ADDR A:0x61d05088
y.create.l HWIO_VENUS0_VENUS_VPP_SE_ENC_PACKER_EXT0_BUFSIZE_ADDR A:0x61d0508c
y.create.l HWIO_VENUS0_VENUS_VPP_SE_ENC_PACKER_EXT1_OFFSET_ADDR A:0x61d05090
y.create.l HWIO_VENUS0_VENUS_VPP_SE_ENC_PACKER_EXT1_BUFSIZE_ADDR A:0x61d05094
y.create.l HWIO_VENUS0_VENUS_VPP_SE_ENC_BIT_BUF_WR_OFFSET_STATUS_ADDR A:0x61d05098
y.create.l HWIO_VENUS0_VENUS_VPP_SE_ENC_SLICE_INFO_BUF_WR_OFFSET_ADDR A:0x61d0509c
y.create.l HWIO_VENUS0_VENUS_VPP_SE_ENC_SLICE_INFO_BUF_SIZE_ADDR A:0x61d050a0
y.create.l HWIO_VENUS0_VENUS_VPP_SE_ENC_SLICE_BIT_COUNT_LIMIT_ADDR A:0x61d050a4
y.create.l HWIO_VENUS0_VENUS_VPP_SE_ENC_NUM_EPC_ADDR A:0x61d050a8
y.create.l HWIO_VENUS0_VENUS_VPP_SE_ENC_NUM_SLICE_ADDR A:0x61d050ac
y.create.l HWIO_VENUS0_VENUS_VPP_SE_ENC_SLICE_INFO_OFFSET_ADDR A:0x61d050b0
y.create.l HWIO_VENUS0_VENUS_VPP_SE_ENC_SLICE_INFO_SIZE_ADDR A:0x61d050b4
y.create.l HWIO_VENUS0_VENUS_VPP_SE_ENC_SLICE_INFO_FIFO_STATUS_ADDR A:0x61d050b8
y.create.l HWIO_VENUS0_VENUS_VSP_SE_ENC_TILE_INIT_ADDR A:0x61d050bc
y.create.l HWIO_VENUS0_VENUS_VPP_SE_ENC_SPARE_0_ADDR A:0x61d050c0
y.create.l HWIO_VENUS0_VENUS_VPP_SE_ENC_SPARE_1_ADDR A:0x61d050c4
y.create.l HWIO_VENUS0_VENUS_VPP_PE_ENC_PIC_SIZE_ADDR A:0x61d06000
y.create.l HWIO_VENUS0_VENUS_VPP_PE_ENC_PIC_CFG_ADDR A:0x61d06004
y.create.l HWIO_VENUS0_VENUS_VPP_PE_ENC_REF_BYTES_PER_LINE_ADDR A:0x61d06008
y.create.l HWIO_VENUS0_VENUS_VPP_PE_ENC_FRAME_CONTROL_ADDR A:0x61d0600c
y.create.l HWIO_VENUS0_VENUS_VPP_PE_ENC_FRAME_ENC_CFG_ADDR A:0x61d06010
y.create.l HWIO_VENUS0_VENUS_VPP_PE_ENC_IRQ_MASK_ADDR A:0x61d06014
y.create.l HWIO_VENUS0_VENUS_VPP_PE_ENC_IRQ_STATUS_ADDR A:0x61d06018
y.create.l HWIO_VENUS0_VENUS_VPP_PE_ENC_IRQ_CLEAR_ADDR A:0x61d0601c
y.create.l HWIO_VENUS0_VENUS_VPP_PE_ENC_TEST_BUS_CONTROL_ADDR A:0x61d06020
y.create.l HWIO_VENUS0_VENUS_VPP_PE_ENC_TEST_BUS_REGISTER_ADDR A:0x61d06024
y.create.l HWIO_VENUS0_VENUS_VPP_PE_ENC_SPARE_0_ADDR A:0x61d06028
y.create.l HWIO_VENUS0_VENUS_VPP_TE_ENC_PIC_CFG_ADDR A:0x61d07000
y.create.l HWIO_VENUS0_VENUS_VPP_TE_ENC_PIC_ENC_CFG_ADDR A:0x61d07004
y.create.l HWIO_VENUS0_VENUS_VPP_TE_ENC_ZBD_LUMA_CFG_ADDR A:0x61d07008
y.create.l HWIO_VENUS0_VENUS_VPP_TE_ENC_ZBD_CHROMA_CFG_ADDR A:0x61d0700c
y.create.l HWIO_VENUS0_VENUS_VPP_TE_ENC_REDO_INTRA_LUMA_CFG_ADDR A:0x61d07010
y.create.l HWIO_VENUS0_VENUS_VPP_TE_ENC_REDO_INTRA_CHROMA_CFG_ADDR A:0x61d07014
y.create.l HWIO_VENUS0_VENUS_VPP_TE_ENC_TS_LUMA_CFG_ADDR A:0x61d07018
y.create.l HWIO_VENUS0_VENUS_VPP_TE_ENC_TS_CHROMA_CFG_ADDR A:0x61d0701c
y.create.l HWIO_VENUS0_VENUS_VPP_TE_ENC_RC_FRAME_CFG_ADDR A:0x61d07020
y.create.l HWIO_VENUS0_VENUS_VPP_TE_ENC_FRAME_QP_CFG_ADDR A:0x61d07024
y.create.l HWIO_VENUS0_VENUS_VPP_TE_ENC_RC_RHO_QP_CTRL_ADDR A:0x61d07028
y.create.l HWIO_VENUS0_VENUS_VPP_TE_ENC_RC_RHO_QP_L_BOUND_ADDR A:0x61d0702c
y.create.l HWIO_VENUS0_VENUS_VPP_TE_ENC_RC_RHO_QP_L_BOUND_Y2_ADDR A:0x61d07030
y.create.l HWIO_VENUS0_VENUS_VPP_TE_ENC_RC_RHO_QP_L_BOUND_CHROMA_ADDR A:0x61d07034
y.create.l HWIO_VENUS0_VENUS_VPP_TE_ENC_RC_RHO_QP_U_BOUND_ADDR A:0x61d07038
y.create.l HWIO_VENUS0_VENUS_VPP_TE_ENC_RC_RHO_QP_U_BOUND_Y2_ADDR A:0x61d0703c
y.create.l HWIO_VENUS0_VENUS_VPP_TE_ENC_RC_RHO_QP_U_BOUND_CHROMA_ADDR A:0x61d07040
y.create.l HWIO_VENUS0_VENUS_VPP_TE_ENC_RC_MB_LCU_QP_LIMIT_ADDR A:0x61d07044
y.create.l HWIO_VENUS0_VENUS_VPP_TE_ENC_RC_MB_LCU_CFG_ADDR A:0x61d07048
y.create.l HWIO_VENUS0_VENUS_VPP_TE_ENC_RC_TARGET_FRAME_BITS_ADDR A:0x61d0704c
y.create.l HWIO_VENUS0_VENUS_VPP_TE_ENC_RC_SLICE_SIZE_ADDR A:0x61d07050
y.create.l HWIO_VENUS0_VENUS_VPP_TE_ENC_RC_COMPLEXITY_PARAM_ADDR A:0x61d07054
y.create.l HWIO_VENUS0_VENUS_VPP_TE_ENC_FRAME_SIZE_ADDR A:0x61d07058
y.create.l HWIO_VENUS0_VENUS_VPP_TE_ENC_STATUS_ADDR A:0x61d0705c
y.create.l HWIO_VENUS0_VENUS_VPP_TE_ENC_SPARE_ADDR A:0x61d07060
y.create.l HWIO_VENUS0_VENUS_VPP_TE_ENC_SW_RESET_ADDR A:0x61d07064
y.create.l HWIO_VENUS0_VENUS_VPP_TE_ENC_IRQ_MASK_ADDR A:0x61d07068
y.create.l HWIO_VENUS0_VENUS_VPP_TE_ENC_IRQ_STATUS_ADDR A:0x61d0706c
y.create.l HWIO_VENUS0_VENUS_VPP_TE_ENC_IRQ_CLEAR_ADDR A:0x61d07070
y.create.l HWIO_VENUS0_VENUS_VPP_TE_ENC_TEST_BUS_CONTROL_ADDR A:0x61d07074
y.create.l HWIO_VENUS0_VENUS_VPP_TE_ENC_TEST_BUS_REGISTER_ADDR A:0x61d07078
y.create.l HWIO_VENUS0_VENUS_VPP_TE_ENC_RC_MB_SB_SEG_CFG0_ADDR A:0x61d0707c
y.create.l HWIO_VENUS0_VENUS_VPP_TE_ENC_RC_MB_SB_SEG_CFG1_ADDR A:0x61d07080
y.create.l HWIO_VENUS0_VENUS_VPP_TE_ENC_RC_CQP_ADDR_ADDR A:0x61d07084
y.create.l HWIO_VENUS0_VENUS_VPP_TE_ENC_RC_CQP_DATA_ADDR A:0x61d07088
y.create.l HWIO_VENUS0_VENUS_VPP_TE_ENC_RC_CQP_MSB_0_ADDR A:0x61d0708c
y.create.l HWIO_VENUS0_VENUS_VPP_TE_ENC_RC_CQP_MSB_1_ADDR A:0x61d07090
y.create.l HWIO_VENUS0_VENUS_VPP_TE_ENC_RC_CQP_MSB_2_ADDR A:0x61d07094
y.create.l HWIO_VENUS0_VENUS_VPP_TE_ENC_RC_CQP_MSB_3_ADDR A:0x61d07098
y.create.l HWIO_VENUS0_VENUS_VPP_TE_ENC_RC_CQP_MSB_4_ADDR A:0x61d0709c
y.create.l HWIO_VENUS0_VENUS_VPP_TE_ENC_SPARE_1_ADDR A:0x61d070a0
y.create.l HWIO_VENUS0_VENUS_VPP_FE_ENC_PIC_CFG_ADDR A:0x61d08000
y.create.l HWIO_VENUS0_VENUS_VPP_FE_ENC_PIC_SIZE_ADDR A:0x61d08004
y.create.l HWIO_VENUS0_VENUS_VPP_FE_ENC_REF_BYTES_PER_LINE_ADDR A:0x61d08008
y.create.l HWIO_VENUS0_VENUS_VPP_FE_ENC_CODEC_CONFIG_ADDR A:0x61d0800c
y.create.l HWIO_VENUS0_VENUS_VPP_FE_ENC_PIC_CFG1_ADDR A:0x61d08010
y.create.l HWIO_VENUS0_VENUS_VPP_FE_ENC_SAO_MODE0_CFG_ADDR A:0x61d08014
y.create.l HWIO_VENUS0_VENUS_VPP_FE_ENC_SAO_MODE1_CFG_ADDR A:0x61d08018
y.create.l HWIO_VENUS0_VENUS_VPP_FE_ENC_SAO_EO_CLASS_LUMA_CFG_ADDR A:0x61d0801c
y.create.l HWIO_VENUS0_VENUS_VPP_FE_ENC_SAO_EO_CLASS_CHROMA_CFG_ADDR A:0x61d08020
y.create.l HWIO_VENUS0_VENUS_VPP_FE_ENC_SAO_SAO_STATS_ADDR A:0x61d08024
y.create.l HWIO_VENUS0_VENUS_VPP_FE_ENC_STATUS_ADDR A:0x61d08028
y.create.l HWIO_VENUS0_VENUS_VPP_FE_ENC_IRQ_MASK_ADDR A:0x61d0802c
y.create.l HWIO_VENUS0_VENUS_VPP_FE_ENC_IRQ_STATUS_ADDR A:0x61d08030
y.create.l HWIO_VENUS0_VENUS_VPP_FE_ENC_IRQ_CLEAR_ADDR A:0x61d08034
y.create.l HWIO_VENUS0_VENUS_VPP_FE_ENC_SPARE_0_ADDR A:0x61d08038
y.create.l HWIO_VENUS0_VENUS_VPP_SSE_ENC_FRAME_CONFIG_0_ADDR A:0x61d09000
y.create.l HWIO_VENUS0_VENUS_VPP_SSE_ENC_FRAME_CONFIG_1_ADDR A:0x61d09004
y.create.l HWIO_VENUS0_VENUS_VPP_SSE_ENC_SRCH_RANGE_ADDR A:0x61d09008
y.create.l HWIO_VENUS0_VENUS_VPP_SSE_ENC_FRAME_BBOX_ADDR A:0x61d0900c
y.create.l HWIO_VENUS0_VENUS_VPP_SSE_ENC_TESTBUS_SEL_ADDR A:0x61d09010
y.create.l HWIO_VENUS0_VENUS_VPP_SSE_ENC_STATUS_ADDR A:0x61d09014
y.create.l HWIO_VENUS0_VENUS_VPP_SSE_ENC_SPARE_ADDR A:0x61d09018
y.create.l HWIO_VENUS0_VENUS_VPP_SSE_ENC_SPARE_1_ADDR A:0x61d0901c
y.create.l HWIO_VENUS0_VENUS_VPP_ISE_ENC_CONFIG_ADDR A:0x61d0a000
y.create.l HWIO_VENUS0_VENUS_VPP_ISE_ENC_FRAME_SIZE_ADDR A:0x61d0a004
y.create.l HWIO_VENUS0_VENUS_VPP_ISE_ENC_SHAPE_CTRL_ADDR A:0x61d0a008
y.create.l HWIO_VENUS0_VENUS_VPP_ISE_ENC_SHAPE_BIAS_0_ADDR A:0x61d0a00c
y.create.l HWIO_VENUS0_VENUS_VPP_ISE_ENC_SHAPE_BIAS_1_ADDR A:0x61d0a010
y.create.l HWIO_VENUS0_VENUS_VPP_ISE_ENC_SHAPE_BIAS_2_ADDR A:0x61d0a014
y.create.l HWIO_VENUS0_VENUS_VPP_ISE_ENC_PRED_DIR_CTRL_ADDR A:0x61d0a018
y.create.l HWIO_VENUS0_VENUS_VPP_ISE_ENC_PRED_BIAS_ADDR A:0x61d0a01c
y.create.l HWIO_VENUS0_VENUS_VPP_ISE_ENC_RANGE_LIMIT_MVX_ADDR A:0x61d0a020
y.create.l HWIO_VENUS0_VENUS_VPP_ISE_ENC_RANGE_LIMIT_MVY_ADDR A:0x61d0a024
y.create.l HWIO_VENUS0_VENUS_VPP_ISE_ENC_PMV_SRCH_CONFIG_ADDR A:0x61d0a028
y.create.l HWIO_VENUS0_VENUS_VPP_ISE_ENC_PMV_PROC_ORDER_0_ADDR A:0x61d0a02c
y.create.l HWIO_VENUS0_VENUS_VPP_ISE_ENC_PMV_PROC_ORDER_1_ADDR A:0x61d0a030
y.create.l HWIO_VENUS0_VENUS_VPP_ISE_ENC_PMV_PROC_ORDER_2_ADDR A:0x61d0a034
y.create.l HWIO_VENUS0_VENUS_VPP_ISE_ENC_PMV_PROC_ORDER_3_ADDR A:0x61d0a038
y.create.l HWIO_VENUS0_VENUS_VPP_ISE_ENC_PMV_PROC_ORDER_4_ADDR A:0x61d0a03c
y.create.l HWIO_VENUS0_VENUS_VPP_ISE_ENC_PMV_PROC_ORDER_5_ADDR A:0x61d0a040
y.create.l HWIO_VENUS0_VENUS_VPP_ISE_ENC_STATUS_ADDR A:0x61d0a044
y.create.l HWIO_VENUS0_VENUS_VPP_ISE_ENC_TESTBUS_SEL_ADDR A:0x61d0a048
y.create.l HWIO_VENUS0_VENUS_VPP_ISE_ENC_SPARE_ADDR A:0x61d0a04c
y.create.l HWIO_VENUS0_VENUS_VPP_ISE_ENC_SPARE_1_ADDR A:0x61d0a050
y.create.l HWIO_VENUS0_VENUS_VPP_FSE_ENC_CFG_FRAME_SIZE_ADDR A:0x61d0b000
y.create.l HWIO_VENUS0_VENUS_VPP_FSE_ENC_CFG_FRAME_CONTROL_ADDR A:0x61d0b004
y.create.l HWIO_VENUS0_VENUS_VPP_FSE_ENC_CFG_FS_SEARCH_ENABLE_ADDR A:0x61d0b008
y.create.l HWIO_VENUS0_VENUS_VPP_FSE_ENC_CFG_FS_SEARCH_DIR_ADDR A:0x61d0b00c
y.create.l HWIO_VENUS0_VENUS_VPP_FSE_ENC_CFG_FS_ENABLE_MER_DIRECT_MODES_ADDR A:0x61d0b010
y.create.l HWIO_VENUS0_VENUS_VPP_FSE_ENC_CFG_FS_MER_PU_BIAS0_ADDR A:0x61d0b014
y.create.l HWIO_VENUS0_VENUS_VPP_FSE_ENC_CFG_FS_MER_PU_BIAS1_ADDR A:0x61d0b018
y.create.l HWIO_VENUS0_VENUS_VPP_FSE_ENC_CFG_FS_PU_SHAPE_BIAS0_ADDR A:0x61d0b01c
y.create.l HWIO_VENUS0_VENUS_VPP_FSE_ENC_CFG_FS_PU_SHAPE_BIAS1_ADDR A:0x61d0b020
y.create.l HWIO_VENUS0_VENUS_VPP_FSE_ENC_CFG_FS_PRED_DIR_BIAS_ADDR A:0x61d0b024
y.create.l HWIO_VENUS0_VENUS_VPP_FSE_ENC_CFG_SE_CONFIG_BIAS0_ADDR A:0x61d0b028
y.create.l HWIO_VENUS0_VENUS_VPP_FSE_ENC_CFG_SE_CONFIG_BIAS1_ADDR A:0x61d0b02c
y.create.l HWIO_VENUS0_VENUS_VPP_FSE_ENC_CFG_MD_INTRA_BIAS_ADDR A:0x61d0b030
y.create.l HWIO_VENUS0_VENUS_VPP_FSE_ENC_CFG_MD_CU_BIAS_ADDR A:0x61d0b034
y.create.l HWIO_VENUS0_VENUS_VPP_FSE_ENC_CFG_FS_MER_PROCESS_ORDER0_ADDR A:0x61d0b038
y.create.l HWIO_VENUS0_VENUS_VPP_FSE_ENC_CFG_FS_MER_PROCESS_ORDER1_ADDR A:0x61d0b03c
y.create.l HWIO_VENUS0_VENUS_VPP_FSE_ENC_CFG_FS_MER_PROCESS_ORDER2_ADDR A:0x61d0b040
y.create.l HWIO_VENUS0_VENUS_VPP_FSE_ENC_CFG_FS_MER_PROCESS_ORDER3_ADDR A:0x61d0b044
y.create.l HWIO_VENUS0_VENUS_VPP_FSE_ENC_CFG_FS_MER_PROCESS_ORDER4_ADDR A:0x61d0b048
y.create.l HWIO_VENUS0_VENUS_VPP_FSE_ENC_CFG_SE_4X4_MODES0_ADDR A:0x61d0b04c
y.create.l HWIO_VENUS0_VENUS_VPP_FSE_ENC_CFG_SE_4X4_MODES1_ADDR A:0x61d0b050
y.create.l HWIO_VENUS0_VENUS_VPP_FSE_ENC_CFG_SE_8X8_MODES0_ADDR A:0x61d0b054
y.create.l HWIO_VENUS0_VENUS_VPP_FSE_ENC_CFG_SE_8X8_MODES1_ADDR A:0x61d0b058
y.create.l HWIO_VENUS0_VENUS_VPP_FSE_ENC_CFG_SE_16X16_MODES0_ADDR A:0x61d0b05c
y.create.l HWIO_VENUS0_VENUS_VPP_FSE_ENC_CFG_SE_16X16_MODES1_ADDR A:0x61d0b060
y.create.l HWIO_VENUS0_VENUS_VPP_FSE_ENC_CFG_SE_32X32_MODES0_ADDR A:0x61d0b064
y.create.l HWIO_VENUS0_VENUS_VPP_FSE_ENC_CFG_SE_32X32_MODES1_ADDR A:0x61d0b068
y.create.l HWIO_VENUS0_VENUS_VPP_FSE_ENC_FS_COST_BIAS_ADDR A:0x61d0b06c
y.create.l HWIO_VENUS0_VENUS_VPP_FSE_ENC_SE_I4X4_VPX_BIAS_ADDR A:0x61d0b070
y.create.l HWIO_VENUS0_VENUS_VPP_FSE_ENC_SE_I16X16_BIAS_ADDR A:0x61d0b074
y.create.l HWIO_VENUS0_VENUS_VPP_FSE_ENC_GMO_MV_ADDR A:0x61d0b078
y.create.l HWIO_VENUS0_VENUS_VPP_FSE_ENC_DBG_TEST_BUS_SEL_ADDR A:0x61d0b080
y.create.l HWIO_VENUS0_VENUS_VPP_FSE_ENC_FS_PIXEL_CONTROL_ADDR A:0x61d0b084
y.create.l HWIO_VENUS0_VENUS_VPP_FSE_ENC_SPARE_ADDR A:0x61d0b088
y.create.l HWIO_VENUS0_VENUS_VPP_FSE_ENC_SPARE_1_ADDR A:0x61d0b08c
y.create.l HWIO_VENUS0_VENUS_VPP_VPE_ENC_STATUS_ADDR A:0x61d0c000
y.create.l HWIO_VENUS0_VENUS_VPP_VPE_ENC_PIPELINE_SIZE_ADDR A:0x61d0c004
y.create.l HWIO_VENUS0_VENUS_VPP_VPE_ENC_FRAME_SIZE_ADDR A:0x61d0c008
y.create.l HWIO_VENUS0_VENUS_VPP_VPE_ENC_OUT_ROI_SIZE_ADDR A:0x61d0c00c
y.create.l HWIO_VENUS0_VENUS_VPP_VPE_ENC_CFG_ADDR A:0x61d0c010
y.create.l HWIO_VENUS0_VENUS_VPP_VPE_ENC_SRC_UNPACK_PATTERN_ADDR A:0x61d0c014
y.create.l HWIO_VENUS0_VENUS_VPP_VPE_ENC_SRC_SIZE_ADDR A:0x61d0c018
y.create.l HWIO_VENUS0_VENUS_VPP_VPE_ENC_SRC_XY_ADDR A:0x61d0c01c
y.create.l HWIO_VENUS0_VENUS_VPP_VPE_ENC_SRC_IMAGE_SIZE_ADDR A:0x61d0c020
y.create.l HWIO_VENUS0_VENUS_VPP_VPE_ENC_P0_EXTADDR_ADDR A:0x61d0c024
y.create.l HWIO_VENUS0_VENUS_VPP_VPE_ENC_P1_EXTADDR_ADDR A:0x61d0c028
y.create.l HWIO_VENUS0_VENUS_VPP_VPE_ENC_P2_EXTADDR_ADDR A:0x61d0c02c
y.create.l HWIO_VENUS0_VENUS_VPP_VPE_ENC_SRC_YSTRIDE_ADDR A:0x61d0c030
y.create.l HWIO_VENUS0_VENUS_VPP_VPE_ENC_SCALE_PHASEX_STEP_ADDR A:0x61d0c034
y.create.l HWIO_VENUS0_VENUS_VPP_VPE_ENC_SCALE_PHASEY_STEP_ADDR A:0x61d0c038
y.create.l HWIO_VENUS0_VENUS_VPP_VPE_ENC_VC1_RANGE_ADDR A:0x61d0c03c
y.create.l HWIO_VENUS0_VENUS_VPP_VPE_ENC_OCMEM_BUF_CONFIG_ADDR A:0x61d0c040
y.create.l HWIO_VENUS0_VENUS_VPP_VPE_ENC_P0_OCMEM_EXTADDR_ADDR A:0x61d0c044
y.create.l HWIO_VENUS0_VENUS_VPP_VPE_ENC_P1_OCMEM_EXTADDR_ADDR A:0x61d0c048
y.create.l HWIO_VENUS0_VENUS_VPP_VPE_ENC_CYCLE_COUNT_ADDR A:0x61d0c050
y.create.l HWIO_VENUS0_VENUS_VPP_VPE_ENC_STEP_MODE_ADDR A:0x61d0c070
y.create.l HWIO_VENUS0_VENUS_VPP_VPE_ENC_CLOCK_CONFIG_ADDR A:0x61d0c074
y.create.l HWIO_VENUS0_VENUS_VPP_VPE_ENC_TESTBUS_SEL_ADDR A:0x61d0c078
y.create.l HWIO_VENUS0_VENUS_VPP_VPE_ENC_SPARE_REG_ADDR A:0x61d0c07c
y.create.l HWIO_VENUS0_VENUS_VPP_VPE_ENC_FETCH_CFG_ADDR A:0x61d0c080
y.create.l HWIO_VENUS0_VENUS_VPP_VPE_ENC_FETCH_STATS_ADDR A:0x61d0c084
y.create.l HWIO_VENUS0_VENUS_VPP_VPE_ENC_FETCH_COUNT_ADDR A:0x61d0c088
y.create.l HWIO_VENUS0_VENUS_VPP_VPE_ENC_MB_POS_ADDR A:0x61d0c08c
y.create.l HWIO_VENUS0_VENUS_VPP_VPE_ENC_DEINT_DECISION_ADDR A:0x61d0c090
y.create.l HWIO_VENUS0_VENUS_VPP_VPE_ENC_DEINT_COEFF0_ADDR A:0x61d0c094
y.create.l HWIO_VENUS0_VENUS_VPP_VPE_ENC_DEINT_COEFF1_ADDR A:0x61d0c098
y.create.l HWIO_VENUS0_VENUS_VPP_VPE_ENC_CSC_MV10_ADDR A:0x61d0c0a0
y.create.l HWIO_VENUS0_VENUS_VPP_VPE_ENC_CSC_MV11_ADDR A:0x61d0c0a4
y.create.l HWIO_VENUS0_VENUS_VPP_VPE_ENC_CSC_MV12_ADDR A:0x61d0c0a8
y.create.l HWIO_VENUS0_VENUS_VPP_VPE_ENC_CSC_MV13_ADDR A:0x61d0c0ac
y.create.l HWIO_VENUS0_VENUS_VPP_VPE_ENC_CSC_MV14_ADDR A:0x61d0c0b0
y.create.l HWIO_VENUS0_VENUS_VPP_VPE_ENC_CSC_MV15_ADDR A:0x61d0c0b4
y.create.l HWIO_VENUS0_VENUS_VPP_VPE_ENC_CSC_MV16_ADDR A:0x61d0c0b8
y.create.l HWIO_VENUS0_VENUS_VPP_VPE_ENC_CSC_MV17_ADDR A:0x61d0c0bc
y.create.l HWIO_VENUS0_VENUS_VPP_VPE_ENC_CSC_MV18_ADDR A:0x61d0c0c0
y.create.l HWIO_VENUS0_VENUS_VPP_VPE_ENC_CSC_PRE_BV10_ADDR A:0x61d0c0d0
y.create.l HWIO_VENUS0_VENUS_VPP_VPE_ENC_CSC_PRE_BV11_ADDR A:0x61d0c0d4
y.create.l HWIO_VENUS0_VENUS_VPP_VPE_ENC_CSC_PRE_BV12_ADDR A:0x61d0c0d8
y.create.l HWIO_VENUS0_VENUS_VPP_VPE_ENC_CSC_POST_BV10_ADDR A:0x61d0c0f0
y.create.l HWIO_VENUS0_VENUS_VPP_VPE_ENC_CSC_POST_BV11_ADDR A:0x61d0c0f4
y.create.l HWIO_VENUS0_VENUS_VPP_VPE_ENC_CSC_POST_BV12_ADDR A:0x61d0c0f8
y.create.l HWIO_VENUS0_VENUS_VPP_VPE_ENC_CSC_PRE_LV10_ADDR A:0x61d0c100
y.create.l HWIO_VENUS0_VENUS_VPP_VPE_ENC_CSC_PRE_LV11_ADDR A:0x61d0c104
y.create.l HWIO_VENUS0_VENUS_VPP_VPE_ENC_CSC_PRE_LV12_ADDR A:0x61d0c108
y.create.l HWIO_VENUS0_VENUS_VPP_VPE_ENC_CSC_PRE_LV13_ADDR A:0x61d0c10c
y.create.l HWIO_VENUS0_VENUS_VPP_VPE_ENC_CSC_PRE_LV14_ADDR A:0x61d0c110
y.create.l HWIO_VENUS0_VENUS_VPP_VPE_ENC_CSC_PRE_LV15_ADDR A:0x61d0c114
y.create.l HWIO_VENUS0_VENUS_VPP_VPE_ENC_CSC_POST_LV10_ADDR A:0x61d0c120
y.create.l HWIO_VENUS0_VENUS_VPP_VPE_ENC_CSC_POST_LV11_ADDR A:0x61d0c124
y.create.l HWIO_VENUS0_VENUS_VPP_VPE_ENC_CSC_POST_LV12_ADDR A:0x61d0c128
y.create.l HWIO_VENUS0_VENUS_VPP_VPE_ENC_CSC_POST_LV13_ADDR A:0x61d0c12c
y.create.l HWIO_VENUS0_VENUS_VPP_VPE_ENC_CSC_POST_LV14_ADDR A:0x61d0c130
y.create.l HWIO_VENUS0_VENUS_VPP_VPE_ENC_CSC_POST_LV15_ADDR A:0x61d0c134
y.create.l HWIO_VENUS0_VENUS_VPP_VPE_ENC_SPARE_0_ADDR A:0x61d0c138
y.create.l HWIO_VENUS0_VENUS_VPP_MVP_ENC_FRAME_CFG_ADDR A:0x61d0d000
y.create.l HWIO_VENUS0_VENUS_VPP_MVP_ENC_COLOCATED_CFG_ADDR A:0x61d0d004
y.create.l HWIO_VENUS0_VENUS_VPP_MVP_ENC_FRAME_SIZE_ADDR A:0x61d0d008
y.create.l HWIO_VENUS0_VENUS_VPP_MVP_ENC_SPAT_GMO_ADDR A:0x61d0d00c
y.create.l HWIO_VENUS0_VENUS_VPP_MVP_ENC_TEMP_GMO_ADDR A:0x61d0d010
y.create.l HWIO_VENUS0_VENUS_VPP_MVP_ENC_SEARCH_RANGE_MVX_ADDR A:0x61d0d014
y.create.l HWIO_VENUS0_VENUS_VPP_MVP_ENC_SEARCH_RANGE_MVY_ADDR A:0x61d0d018
y.create.l HWIO_VENUS0_VENUS_VPP_MVP_ENC_FRAME_BBOX_ADDR A:0x61d0d01c
y.create.l HWIO_VENUS0_VENUS_VPP_MVP_ENC_SPAT_MULT_FACTOR0_ADDR A:0x61d0d020
y.create.l HWIO_VENUS0_VENUS_VPP_MVP_ENC_SPAT_MULT_FACTOR1_ADDR A:0x61d0d024
y.create.l HWIO_VENUS0_VENUS_VPP_MVP_ENC_TEMP_MULT_FACTOR0_ADDR A:0x61d0d028
y.create.l HWIO_VENUS0_VENUS_VPP_MVP_ENC_TEMP_MULT_FACTOR1_ADDR A:0x61d0d02c
y.create.l HWIO_VENUS0_VENUS_VPP_MVP_ENC_TEMP_MULT_FACTOR2_ADDR A:0x61d0d030
y.create.l HWIO_VENUS0_VENUS_VPP_MVP_ENC_TEMP_MULT_FACTOR3_ADDR A:0x61d0d034
y.create.l HWIO_VENUS0_VENUS_VPP_MVP_ENC_HOR_BIN0_ADDR A:0x61d0d038
y.create.l HWIO_VENUS0_VENUS_VPP_MVP_ENC_HOR_BIN1_ADDR A:0x61d0d03c
y.create.l HWIO_VENUS0_VENUS_VPP_MVP_ENC_HOR_BIN2_ADDR A:0x61d0d040
y.create.l HWIO_VENUS0_VENUS_VPP_MVP_ENC_HOR_BIN3_ADDR A:0x61d0d044
y.create.l HWIO_VENUS0_VENUS_VPP_MVP_ENC_HOR_BIN4_ADDR A:0x61d0d048
y.create.l HWIO_VENUS0_VENUS_VPP_MVP_ENC_HOR_BIN5_ADDR A:0x61d0d04c
y.create.l HWIO_VENUS0_VENUS_VPP_MVP_ENC_HOR_BIN6_ADDR A:0x61d0d050
y.create.l HWIO_VENUS0_VENUS_VPP_MVP_ENC_HOR_BIN7_ADDR A:0x61d0d054
y.create.l HWIO_VENUS0_VENUS_VPP_MVP_ENC_HOR_BIN8_ADDR A:0x61d0d058
y.create.l HWIO_VENUS0_VENUS_VPP_MVP_ENC_HOR_BIN9_ADDR A:0x61d0d05c
y.create.l HWIO_VENUS0_VENUS_VPP_MVP_ENC_VER_BIN0_ADDR A:0x61d0d060
y.create.l HWIO_VENUS0_VENUS_VPP_MVP_ENC_VER_BIN1_ADDR A:0x61d0d064
y.create.l HWIO_VENUS0_VENUS_VPP_MVP_ENC_VER_BIN2_ADDR A:0x61d0d068
y.create.l HWIO_VENUS0_VENUS_VPP_MVP_ENC_VER_BIN3_ADDR A:0x61d0d06c
y.create.l HWIO_VENUS0_VENUS_VPP_MVP_ENC_VER_BIN4_ADDR A:0x61d0d070
y.create.l HWIO_VENUS0_VENUS_VPP_MVP_ENC_HOR_SUM_ADDR A:0x61d0d078
y.create.l HWIO_VENUS0_VENUS_VPP_MVP_ENC_VER_SUM_ADDR A:0x61d0d07c
y.create.l HWIO_VENUS0_VENUS_VPP_MVP_ENC_STAT_INTER_CNT_ADDR A:0x61d0d080
y.create.l HWIO_VENUS0_VENUS_VPP_MVP_ENC_STATUS_ADDR A:0x61d0d084
y.create.l HWIO_VENUS0_VENUS_VPP_MVP_ENC_TEST_BUS_SEL_ADDR A:0x61d0d088
y.create.l HWIO_VENUS0_VENUS_VPP_MVP_ENC_SPARE_ADDR A:0x61d0d08c
y.create.l HWIO_VENUS0_VENUS_VPP_MVP_ENC_DSR_ADDR A:0x61d0d090
y.create.l HWIO_VENUS0_VENUS_VPP_MVP_ENC_SPARE_1_ADDR A:0x61d0d094
y.create.l HWIO_VENUS0_VENUS_DMA_ENC_CONFIG_ADDR A:0x61d0f000
y.create.l HWIO_VENUS0_VENUS_DMA_ENC_FETCH_CFG_ADDR A:0x61d0f004
y.create.l HWIO_VENUS0_VENUS_DMA_ENC_DPB_CFG_ADDR A:0x61d0f008
y.create.l HWIO_VENUS0_VENUS_DMA_ENC_UBWC_STATUS_ADDR A:0x61d0f00c
y.create.l HWIO_VENUS0_VENUS_DMA_ENC_LB_DEST_ADDR A:0x61d0f080
y.create.l HWIO_VENUS0_VENUS_DMA_ENC_WB_REF_FRAME_SIZE_ADDR A:0x61d0f084
y.create.l HWIO_VENUS0_VENUS_DMA_ENC_REF_BYTES_PER_LINE_ADDR A:0x61d0f08c
y.create.l HWIO_VENUS0_VENUS_DMA_ENC_VSP_LB_DEST_ADDR A:0x61d0f090
y.create.l HWIO_VENUS0_VENUS_DMA_ENC_REF_CFG_ADDR A:0x61d0f100
y.create.l HWIO_VENUS0_VENUS_DMA_ENC_ROI_MB_OFFSET_ADDR A:0x61d0f104
y.create.l HWIO_VENUS0_VENUS_DMA_ENC_TILE_SIZE_CONFIG_ADDR A:0x61d0f10c
y.create.l HWIO_VENUS0_VENUS_DMA_ENC_REF_CYCLE_COUNT_ADDR A:0x61d0f120
y.create.l HWIO_VENUS0_VENUS_DMA_ENC_REF_OCMEM_BUF_CONFIG_ADDR A:0x61d0f128
y.create.l HWIO_VENUS0_VENUS_DMA_ENC_SUB_REF_RAM_CFG0_ADDR A:0x61d0f180
y.create.l HWIO_VENUS0_VENUS_DMA_ENC_SUB_REF_RAM_CFG1_ADDR A:0x61d0f184
y.create.l HWIO_VENUS0_VENUS_DMA_ENC_REF_FETCH_START_ADDR A:0x61d0f18c
y.create.l HWIO_VENUS0_VENUS_DMA_ENC_BUFF_START_ADDR0_ADDR A:0x61d0f200
y.create.l HWIO_VENUS0_VENUS_DMA_ENC_BUFF_START_ADDR1_ADDR A:0x61d0f204
y.create.l HWIO_VENUS0_VENUS_DMA_ENC_BUFF_START_ADDR2_ADDR A:0x61d0f208
y.create.l HWIO_VENUS0_VENUS_DMA_ENC_BUFF_START_ADDR3_ADDR A:0x61d0f20c
y.create.l HWIO_VENUS0_VENUS_DMA_ENC_BUFF_START_ADDR4_ADDR A:0x61d0f210
y.create.l HWIO_VENUS0_VENUS_DMA_ENC_BUFF_START_ADDR5_ADDR A:0x61d0f214
y.create.l HWIO_VENUS0_VENUS_DMA_ENC_BUFF_START_ADDR6_ADDR A:0x61d0f218
y.create.l HWIO_VENUS0_VENUS_DMA_ENC_BUFF_START_ADDR7_ADDR A:0x61d0f21c
y.create.l HWIO_VENUS0_VENUS_DMA_ENC_BUFF_START_ADDR8_ADDR A:0x61d0f220
y.create.l HWIO_VENUS0_VENUS_DMA_ENC_BUFF_START_ADDR9_ADDR A:0x61d0f224
y.create.l HWIO_VENUS0_VENUS_DMA_ENC_SDE_BIT_BUF_START_INIT_ADDR A:0x61d0f400
y.create.l HWIO_VENUS0_VENUS_DMA_ENC_SDE_BIT_BUF_START_ADDR_ADDR A:0x61d0f404
y.create.l HWIO_VENUS0_VENUS_DMA_ENC_SDE_BIN_BUF_START_INIT_ADDR A:0x61d0f408
y.create.l HWIO_VENUS0_VENUS_DMA_ENC_SDE_BIN_BUF_START_ADDR_ADDR A:0x61d0f40c
y.create.l HWIO_VENUS0_VENUS_DMA_ENC_SE_BIN_BUF_START_INIT_ADDR A:0x61d0f410
y.create.l HWIO_VENUS0_VENUS_DMA_ENC_SE_BIN_BUF_START_ADDR_ADDR A:0x61d0f414
y.create.l HWIO_VENUS0_VENUS_DMA_ENC_BUFF_SSID0_ADDR A:0x61d0f500
y.create.l HWIO_VENUS0_VENUS_DMA_ENC_BUFF_SSID1_ADDR A:0x61d0f504
y.create.l HWIO_VENUS0_VENUS_DMA_ENC_BUFF_SSID2_ADDR A:0x61d0f508
y.create.l HWIO_VENUS0_VENUS_DMA_ENC_BUFF_SSID3_ADDR A:0x61d0f50c
y.create.l HWIO_VENUS0_VENUS_DMA_ENC_BUFF_SSID4_ADDR A:0x61d0f510
y.create.l HWIO_VENUS0_VENUS_DMA_ENC_BUFF_SSID5_ADDR A:0x61d0f514
y.create.l HWIO_VENUS0_VENUS_DMA_ENC_BUFF_SSID6_ADDR A:0x61d0f518
y.create.l HWIO_VENUS0_VENUS_DMA_ENC_BUFF_SSID7_ADDR A:0x61d0f51c
y.create.l HWIO_VENUS0_VENUS_DMA_ENC_BUFF_SSID8_ADDR A:0x61d0f520
y.create.l HWIO_VENUS0_VENUS_DMA_ENC_BUFF_SSID9_ADDR A:0x61d0f524
y.create.l HWIO_VENUS0_VENUS_DMA_ENC_SPARE_0_ADDR A:0x61d0f580
y.create.l HWIO_VENUS0_VENUS_DMA_ENC_SPARE_1_ADDR A:0x61d0f584
y.create.l HWIO_VENUS0_VENUS_DMA_ENC_SPARE_2_ADDR A:0x61d0f588
y.create.l HWIO_VENUS0_VENUS_DMA_ENC_SPARE_3_ADDR A:0x61d0f58c
y.create.l HWIO_VENUS0_VENUS_DMA_ENC_SPARE_4_ADDR A:0x61d0f590
y.create.l HWIO_VENUS0_VENUS_DMA_ENC_SPARE_5_ADDR A:0x61d0f594
y.create.l HWIO_VENUS0_VENUS_DMA_ENC_SPARE_6_ADDR A:0x61d0f598
y.create.l HWIO_VENUS0_VENUS_DMA_ENC_SPARE_7_ADDR A:0x61d0f59c
y.create.l HWIO_VENUS0_VENUS_SS_DEC_INTR_STATUS_ADDR A:0x61d30000
y.create.l HWIO_VENUS0_VENUS_SS_DEC_INTR_MASK_ADDR A:0x61d30004
y.create.l HWIO_VENUS0_VENUS_SS_DEC_SPARE_0_ADDR A:0x61d30008
y.create.l HWIO_VENUS0_VENUS_SS_DEC_CLOCK_HALT_ADDR A:0x61d3000c
y.create.l HWIO_VENUS0_VENUS_SS_DEC_SPARE_1_ADDR A:0x61d30010
y.create.l HWIO_VENUS0_VENUS_SS_DEC_WDLOAD0_ADDR A:0x61d30014
y.create.l HWIO_VENUS0_VENUS_SS_DEC_WDLOAD1_ADDR A:0x61d30018
y.create.l HWIO_VENUS0_VENUS_SS_DEC_WDLOAD2_ADDR A:0x61d3001c
y.create.l HWIO_VENUS0_VENUS_SS_DEC_WDLOAD3_ADDR A:0x61d30020
y.create.l HWIO_VENUS0_VENUS_SS_DEC_WDVALUE0_ADDR A:0x61d30024
y.create.l HWIO_VENUS0_VENUS_SS_DEC_WDVALUE1_ADDR A:0x61d30028
y.create.l HWIO_VENUS0_VENUS_SS_DEC_WDVALUE2_ADDR A:0x61d3002c
y.create.l HWIO_VENUS0_VENUS_SS_DEC_WDVALUE3_ADDR A:0x61d30030
y.create.l HWIO_VENUS0_VENUS_SS_DEC_WD_IRQ_STATUS_ADDR A:0x61d30034
y.create.l HWIO_VENUS0_VENUS_SS_DEC_WD_IRQ_MASK_ADDR A:0x61d30038
y.create.l HWIO_VENUS0_VENUS_SS_DEC_WD_IRQ_CLEAR_ADDR A:0x61d3003c
y.create.l HWIO_VENUS0_VENUS_SS_DEC_CLOCK_EN_ADDR A:0x61d30040
y.create.l HWIO_VENUS0_VENUS_SS_DEC_SW_RESET_ADDR A:0x61d30044
y.create.l HWIO_VENUS0_VENUS_SS_DEC_SPARE_2_ADDR A:0x61d30048
y.create.l HWIO_VENUS0_VENUS_VSP_TOP_DEC_STATUS_ADDR A:0x61d31000
y.create.l HWIO_VENUS0_VENUS_VSP_TOP_DEC_MASK_ADDR A:0x61d31004
y.create.l HWIO_VENUS0_VENUS_VSP_TOP_DEC_SPARE_0_ADDR A:0x61d31008
y.create.l HWIO_VENUS0_VENUS_VSP_TOP_DEC_SPARE_1_ADDR A:0x61d3100c
y.create.l HWIO_VENUS0_VENUS_VSP_TOP_DEC_SPARE_2_ADDR A:0x61d31010
y.create.l HWIO_VENUS0_VENUS_VSP_TOP_DEC_SDE_CP_STATUS_ADDR A:0x61d31014
y.create.l HWIO_VENUS0_VENUS_VSP_CCE_DEC_CMD_ADDR A:0x61d32000
y.create.l HWIO_VENUS0_VENUS_VSP_CCE_DEC_RESULT_ADDR A:0x61d32004
y.create.l HWIO_VENUS0_VENUS_VSP_CCE_DEC_CONFIG_WPT_ADDR A:0x61d3200c
y.create.l HWIO_VENUS0_VENUS_VSP_CCE_DEC_BS_BUF_SIZE_ADDR A:0x61d32010
y.create.l HWIO_VENUS0_VENUS_VSP_CCE_DEC_FIFO_ICH_CONFIG_ADDR A:0x61d32014
y.create.l HWIO_VENUS0_VENUS_VSP_CCE_DEC_BS_READ_OFFSET_ADDR A:0x61d32018
y.create.l HWIO_VENUS0_VENUS_VSP_CCE_DEC_BS_SEG_LEN_ADDR A:0x61d3201c
y.create.l HWIO_VENUS0_VENUS_VSP_CCE_DEC_BS_BIT_OFFSET_ADDR A:0x61d32020
y.create.l HWIO_VENUS0_VENUS_VSP_CCE_DEC_BS_ICH_START_ADDR A:0x61d32024
y.create.l HWIO_VENUS0_VENUS_VSP_CCE_DEC_BS_ICH_STATUS_ADDR A:0x61d32028
y.create.l HWIO_VENUS0_VENUS_VSP_CCE_DEC_BS_ICH_RESET_ADDR A:0x61d3202c
y.create.l HWIO_VENUS0_VENUS_VSP_CCE_DEC_BS_BIT_COUNT_ADDR A:0x61d32030
y.create.l HWIO_VENUS0_VENUS_VSP_CCE_DEC_BS_EPC_COUNT_ADDR A:0x61d32034
y.create.l HWIO_VENUS0_VENUS_VSP_CCE_DEC_BPD_CONFIG1_ADDR A:0x61d32038
y.create.l HWIO_VENUS0_VENUS_VSP_CCE_DEC_BPD_CONFIG2_ADDR A:0x61d3203c
y.create.l HWIO_VENUS0_VENUS_VSP_CCE_DEC_BPD_CONFIG3_ADDR A:0x61d32040
y.create.l HWIO_VENUS0_VENUS_VSP_CCE_DEC_BPD_STATUS_ADDR A:0x61d32044
y.create.l HWIO_VENUS0_VENUS_VSP_CCE_DEC_VP8_HEADER_STATUS_ADDR A:0x61d32048
y.create.l HWIO_VENUS0_VENUS_VSP_CCE_DEC_VP8_KEY_FRAME_SIZE_STATUS_ADDR A:0x61d3204c
y.create.l HWIO_VENUS0_VENUS_VSP_CCE_DEC_VP9_HEADER_STATUS_ADDR A:0x61d32050
y.create.l HWIO_VENUS0_VENUS_VSP_CCE_DEC_VP9_HEADER_NONINTRA_STATUS_ADDR A:0x61d32054
y.create.l HWIO_VENUS0_VENUS_VSP_CCE_DEC_VP9_FRAME_SIZE_STATUS_ADDR A:0x61d32058
y.create.l HWIO_VENUS0_VENUS_VSP_CCE_DEC_VP9_DISP_FRAME_SIZE_STATUS_ADDR A:0x61d3205c
y.create.l HWIO_VENUS0_VENUS_VSP_CCE_DEC_CP_CODEC_CONFIG_ADDR A:0x61d32060
y.create.l HWIO_VENUS0_VENUS_VSP_CCE_DEC_CP_DMA_RD_OFFSET_ADDR A:0x61d32064
y.create.l HWIO_VENUS0_VENUS_VSP_CCE_DEC_CP_DMA_WR_OFFSET_ADDR A:0x61d32068
y.create.l HWIO_VENUS0_VENUS_VSP_CCE_DEC_CP_DMA_SIZE_ADDR A:0x61d3206c
y.create.l HWIO_VENUS0_VENUS_VSP_CCE_DEC_CP_SC_SUFFIX_ADDR A:0x61d32070
y.create.l HWIO_VENUS0_VENUS_VSP_CCE_DEC_FIFO_STATUS_ADDR A:0x61d32074
y.create.l HWIO_VENUS0_VENUS_VSP_CCE_DEC_CMD_STATUS_ADDR A:0x61d32078
y.create.l HWIO_VENUS0_VENUS_VSP_CCE_DEC_CMD_STATUS_CLEAR_ADDR A:0x61d3207c
y.create.l HWIO_VENUS0_VENUS_VSP_CCE_DEC_CMD_IRQ_MASK_ADDR A:0x61d32080
y.create.l HWIO_VENUS0_VENUS_VSP_CCE_DEC_CMD_RSLT_QUEUE_TIMEOUT_CFG_ADDR A:0x61d32084
y.create.l HWIO_VENUS0_VENUS_VSP_CCE_DEC_CMD_TEST_BUS_CONTROL_ADDR A:0x61d32088
y.create.l HWIO_VENUS0_VENUS_VSP_CCE_DEC_CMD_TEST_BUS_REGISTER_ADDR A:0x61d3208c
y.create.l HWIO_VENUS0_VENUS_VSP_CCE_DEC_SW_RESET_ADDR A:0x61d32090
y.create.l HWIO_VENUS0_VENUS_VSP_CCE_DEC_SCS_CMD_ADDR A:0x61d320a0
y.create.l HWIO_VENUS0_VENUS_VSP_CCE_DEC_SCS_BS_BUF_SIZE_ADDR A:0x61d320a4
y.create.l HWIO_VENUS0_VENUS_VSP_CCE_DEC_SCS_FIFO_ICH_CONFIG_ADDR A:0x61d320a8
y.create.l HWIO_VENUS0_VENUS_VSP_CCE_DEC_SCS_BS_READ_OFFSET_ADDR A:0x61d320ac
y.create.l HWIO_VENUS0_VENUS_VSP_CCE_DEC_SCS_BS_SEG_LEN_ADDR A:0x61d320b0
y.create.l HWIO_VENUS0_VENUS_VSP_CCE_DEC_SCS_BS_WR_SEG_LEN_ADDR A:0x61d320b4
y.create.l HWIO_VENUS0_VENUS_VSP_CCE_DEC_SCS_BS_ICH_START_ADDR A:0x61d320b8
y.create.l HWIO_VENUS0_VENUS_VSP_CCE_DEC_SCS_BS_ICH_STATUS_ADDR A:0x61d320bc
y.create.l HWIO_VENUS0_VENUS_VSP_CCE_DEC_SCS_BS_ICH_RESET_ADDR A:0x61d320c0
y.create.l HWIO_VENUS0_VENUS_VSP_CCE_DEC_SCS_BS_BIT_COUNT_ADDR A:0x61d320c4
y.create.l HWIO_VENUS0_VENUS_VSP_CCE_DEC_SCS_CMD_STATUS_ADDR A:0x61d320c8
y.create.l HWIO_VENUS0_VENUS_VSP_CCE_DEC_SCS_CMD_STATUS_CLEAR_ADDR A:0x61d320cc
y.create.l HWIO_VENUS0_VENUS_VSP_CCE_DEC_SCS_CMD_IRQ_MASK_ADDR A:0x61d320d0
y.create.l HWIO_VENUS0_VENUS_VSP_CCE_DEC_SCS_CMD_TEST_BUS_CONTROL_ADDR A:0x61d320d4
y.create.l HWIO_VENUS0_VENUS_VSP_CCE_DEC_SCS_CMD_TEST_BUS_REGISTER_ADDR A:0x61d320d8
y.create.l HWIO_VENUS0_VENUS_VSP_CCE_DEC_SCS_SW_RESET_ADDR A:0x61d320dc
y.create.l HWIO_VENUS0_VENUS_VSP_CCE_DEC_SPARE_0_ADDR A:0x61d320e0
y.create.l HWIO_VENUS0_VENUS_VSP_SDE_DEC_TOP_CODEC_CONFIG_ADDR A:0x61d33000
y.create.l HWIO_VENUS0_VENUS_VSP_SDE_DEC_TOP_FIFO_ICH_CONFIG_ADDR A:0x61d33004
y.create.l HWIO_VENUS0_VENUS_VSP_SDE_DEC_TOP_BIN_BUF_CFG_ADDR A:0x61d33008
y.create.l HWIO_VENUS0_VENUS_VSP_SDE_DEC_TOP_SW_RESET_ADDR A:0x61d3300c
y.create.l HWIO_VENUS0_VENUS_VSP_SDE_DEC_TOP_BIN_BUF_WR_OFFSET0_ADDR A:0x61d33010
y.create.l HWIO_VENUS0_VENUS_VSP_SDE_DEC_TOP_BIN_BUF_WR_OFFSET1_ADDR A:0x61d33014
y.create.l HWIO_VENUS0_VENUS_VSP_SDE_DEC_TOP_BIN_BUF_WR_OFFSET2_ADDR A:0x61d33018
y.create.l HWIO_VENUS0_VENUS_VSP_SDE_DEC_TOP_BIN_BUF_WR_OFFSET3_ADDR A:0x61d3301c
y.create.l HWIO_VENUS0_VENUS_VSP_SDE_DEC_TOP_BIN_BUF_SIZE0_ADDR A:0x61d33020
y.create.l HWIO_VENUS0_VENUS_VSP_SDE_DEC_TOP_BIN_BUF_SIZE1_ADDR A:0x61d33024
y.create.l HWIO_VENUS0_VENUS_VSP_SDE_DEC_TOP_BIN_BUF_SIZE2_ADDR A:0x61d33028
y.create.l HWIO_VENUS0_VENUS_VSP_SDE_DEC_TOP_BIN_BUF_SIZE3_ADDR A:0x61d3302c
y.create.l HWIO_VENUS0_VENUS_VSP_SDE_DEC_TOP_BIT_BUF_SIZE_ADDR A:0x61d33030
y.create.l HWIO_VENUS0_VENUS_VSP_SDE_DEC_TOP_SLICE_CMD_RD_OFFSET_ADDR A:0x61d33034
y.create.l HWIO_VENUS0_VENUS_VSP_SDE_DEC_TOP_SLICE_CMD_BUF_SIZE_ADDR A:0x61d33038
y.create.l HWIO_VENUS0_VENUS_VSP_SDE_DEC_TOP_PIC_DIMENSION_ADDR A:0x61d3303c
y.create.l HWIO_VENUS0_VENUS_VSP_SDE_DEC_TOP_BIN_CNT0_ADDR A:0x61d33040
y.create.l HWIO_VENUS0_VENUS_VSP_SDE_DEC_TOP_BIN_CNT1_ADDR A:0x61d33044
y.create.l HWIO_VENUS0_VENUS_VSP_SDE_DEC_TOP_BIN_CNT2_ADDR A:0x61d33048
y.create.l HWIO_VENUS0_VENUS_VSP_SDE_DEC_TOP_BIN_CNT3_ADDR A:0x61d3304c
y.create.l HWIO_VENUS0_VENUS_VSP_SDE_DEC_TOP_BIT_CNT_ADDR A:0x61d33050
y.create.l HWIO_VENUS0_VENUS_VSP_SDE_DEC_TOP_BIN_EPC_CNT0_ADDR A:0x61d33054
y.create.l HWIO_VENUS0_VENUS_VSP_SDE_DEC_TOP_BIN_EPC_CNT1_ADDR A:0x61d33058
y.create.l HWIO_VENUS0_VENUS_VSP_SDE_DEC_TOP_BIN_EPC_CNT2_ADDR A:0x61d3305c
y.create.l HWIO_VENUS0_VENUS_VSP_SDE_DEC_TOP_BIN_EPC_CNT3_ADDR A:0x61d33060
y.create.l HWIO_VENUS0_VENUS_VSP_SDE_DEC_TOP_BIT_EPC_CNT_ADDR A:0x61d33064
y.create.l HWIO_VENUS0_VENUS_VSP_SDE_DEC_TOP_MB_POS_ADDR A:0x61d33068
y.create.l HWIO_VENUS0_VENUS_VSP_SDE_DEC_TOP_ERR_STATUS_ADDR A:0x61d3306c
y.create.l HWIO_VENUS0_VENUS_VSP_SDE_DEC_TOP_TEST_BUS_CONTROL_ADDR A:0x61d33070
y.create.l HWIO_VENUS0_VENUS_VSP_SDE_DEC_TOP_TEST_BUS_REGISTER_ADDR A:0x61d33074
y.create.l HWIO_VENUS0_VENUS_VSP_SDE_DEC_TOP_SPARE_ADDR A:0x61d33078
y.create.l HWIO_VENUS0_VENUS_VSP_SDE_DEC_TOP_SINGLE_STEP_CONTROL_ADDR A:0x61d3307c
y.create.l HWIO_VENUS0_VENUS_VSP_SDE_DEC_H265D_CFG1_ADDR A:0x61d33080
y.create.l HWIO_VENUS0_VENUS_VSP_SDE_DEC_H265D_CFG2_ADDR A:0x61d33084
y.create.l HWIO_VENUS0_VENUS_VSP_SDE_DEC_H265D_CFG3_ADDR A:0x61d33088
y.create.l HWIO_VENUS0_VENUS_VSP_SDE_DEC_H265D_CFG4_ADDR A:0x61d3308c
y.create.l HWIO_VENUS0_VENUS_VSP_SDE_DEC_H265D_TILE_INIT_ADDR A:0x61d33090
y.create.l HWIO_VENUS0_VENUS_VSP_SDE_DEC_H265D_TILE_X_ADDR A:0x61d33094
y.create.l HWIO_VENUS0_VENUS_VSP_SDE_DEC_H265D_TILE_Y_ADDR A:0x61d33098
y.create.l HWIO_VENUS0_VENUS_VSP_SDE_DEC_H265D_PCM_ADDR A:0x61d3309c
y.create.l HWIO_VENUS0_VENUS_VSP_SDE_DEC_H265D_STATUS_ADDR A:0x61d330a0
y.create.l HWIO_VENUS0_VENUS_VSP_SDE_DEC_H265D_STATUS_CLEAR_ADDR A:0x61d330a4
y.create.l HWIO_VENUS0_VENUS_VSP_SDE_DEC_H265D_STATUS_MASK_ADDR A:0x61d330a8
y.create.l HWIO_VENUS0_VENUS_VSP_SDE_DEC_H264D_PIC_CFG_ADDR A:0x61d330c0
y.create.l HWIO_VENUS0_VENUS_VSP_SDE_DEC_H264D_IRQ_STATUS_ADDR A:0x61d330c4
y.create.l HWIO_VENUS0_VENUS_VSP_SDE_DEC_H264D_IRQ_MASK_ADDR A:0x61d330c8
y.create.l HWIO_VENUS0_VENUS_VSP_SDE_DEC_H264D_IRQ_CLEAR_ADDR A:0x61d330cc
y.create.l HWIO_VENUS0_VENUS_VSP_SDE_DEC_VP9_CFG_0_ADDR A:0x61d330e0
y.create.l HWIO_VENUS0_VENUS_VSP_SDE_DEC_VPX_CFG_1_ADDR A:0x61d330e4
y.create.l HWIO_VENUS0_VENUS_VSP_SDE_DEC_VPXA_IRQ_STATUS_ADDR A:0x61d330e8
y.create.l HWIO_VENUS0_VENUS_VSP_SDE_DEC_VPXA_IRQ_STATUS_CLEAR_ADDR A:0x61d330ec
y.create.l HWIO_VENUS0_VENUS_VSP_SDE_DEC_VPXA_IRQ_MASK_ADDR A:0x61d330f0
y.create.l HWIO_VENUS0_VENUS_VSP_SDE_DEC_VPX_FRAME_HEADER_BIT_CNT_ADDR A:0x61d330f4
y.create.l HWIO_VENUS0_VENUS_VSP_SDE_DEC_VPX_BITSTREAM_BUF_SIZE_ADDR A:0x61d330f8
y.create.l HWIO_VENUS0_VENUS_VSP_SDE_DEC_SPARE_0_ADDR A:0x61d330fc
y.create.l HWIO_VENUS0_VENUS_VPP_TOP_DEC_STATUS_ADDR A:0x61d34000
y.create.l HWIO_VENUS0_VENUS_VPP_TOP_DEC_MASK_ADDR A:0x61d34004
y.create.l HWIO_VENUS0_VENUS_VPP_TOP_DEC_SPARE_0_ADDR A:0x61d34008
y.create.l HWIO_VENUS0_VENUS_VPP_TOP_DEC_SPARE_1_ADDR A:0x61d34010
y.create.l HWIO_VENUS0_VENUS_VPP_TOP_DEC_SPARE_2_ADDR A:0x61d34014
y.create.l HWIO_VENUS0_VENUS_VPP_TOP_DEC_SPARE_3_ADDR A:0x61d34018
y.create.l HWIO_VENUS0_VENUS_VPP_TOP_DEC_SE_CP_STATUS_ADDR A:0x61d3401c
y.create.l HWIO_VENUS0_VENUS_VPP_SE_DEC_TOP_PIC_SIZE_IN_SAMPLES_ADDR A:0x61d35000
y.create.l HWIO_VENUS0_VENUS_VPP_SE_DEC_TOP_OPMODE_CONFIG_ADDR A:0x61d35004
y.create.l HWIO_VENUS0_VENUS_VPP_SE_DEC_FIFO_CONFIG_ADDR A:0x61d35008
y.create.l HWIO_VENUS0_VENUS_VPP_SE_DEC_TOP_BIN_READ_OFFSET_HDR_ADDR A:0x61d3500c
y.create.l HWIO_VENUS0_VENUS_VPP_SE_DEC_TOP_BIN_READ_OFFSET_RES_ADDR A:0x61d35010
y.create.l HWIO_VENUS0_VENUS_VPP_SE_DEC_TOP_SKIP_BITS_HDR_ADDR A:0x61d35014
y.create.l HWIO_VENUS0_VENUS_VPP_SE_DEC_TOP_SKIP_BITS_RES_ADDR A:0x61d35018
y.create.l HWIO_VENUS0_VENUS_VPP_SE_DEC_TOP_BIN_BUFFER_SIZE_HDR_ADDR A:0x61d3501c
y.create.l HWIO_VENUS0_VENUS_VPP_SE_DEC_TOP_BIN_BUFFER_SIZE_RES_ADDR A:0x61d35020
y.create.l HWIO_VENUS0_VENUS_VPP_SE_DEC_TOP_BIN_BUFFER_SEG_LEN_HDR_ADDR A:0x61d35024
y.create.l HWIO_VENUS0_VENUS_VPP_SE_DEC_TOP_BIN_BUFFER_SEG_LEN_RES_ADDR A:0x61d35028
y.create.l HWIO_VENUS0_VENUS_VPP_SE_DEC_TOP_BS_BIT_COUNT_HDR_ADDR A:0x61d3502c
y.create.l HWIO_VENUS0_VENUS_VPP_SE_DEC_TOP_BS_BIT_COUNT_RES_ADDR A:0x61d35030
y.create.l HWIO_VENUS0_VENUS_VPP_SE_DEC_TOP_BS_EPC_COUNT_HDR_ADDR A:0x61d35034
y.create.l HWIO_VENUS0_VENUS_VPP_SE_DEC_TOP_BS_EPC_COUNT_RES_ADDR A:0x61d35038
y.create.l HWIO_VENUS0_VENUS_VPP_SE_DEC_TOP_SLICE_CMD_RD_OFFSET_ADDR A:0x61d3503c
y.create.l HWIO_VENUS0_VENUS_VPP_SE_DEC_TOP_SLICE_CMD_BUF_SIZE_ADDR A:0x61d35040
y.create.l HWIO_VENUS0_VENUS_VPP_SE_DEC_TOP_PIC_SIZE_IN_PIXELS_ADDR A:0x61d35044
y.create.l HWIO_VENUS0_VENUS_VPP_SE_DEC_TOP_SPARE_0_ADDR A:0x61d35048
y.create.l HWIO_VENUS0_VENUS_VPP_SE_DEC_TOP_SW_RESET_ADDR A:0x61d3504c
y.create.l HWIO_VENUS0_VENUS_VPP_SE_DEC_TOP_MVE_POC_TOP_ADDR A:0x61d35050
y.create.l HWIO_VENUS0_VENUS_VPP_SE_DEC_TOP_MVE_POC_BOTTOM_ADDR A:0x61d35054
y.create.l HWIO_VENUS0_VENUS_VPP_SE_DEC_TOP_LT_REF_PIC_ADDR A:0x61d35058
y.create.l HWIO_VENUS0_VENUS_VPP_SE_DEC_TOP_CURR_FRAME_POC_ADDR A:0x61d3505c
y.create.l HWIO_VENUS0_VENUS_VPP_SE_DEC_TOP_COL_TO_LIST0_MAP_0_ADDR A:0x61d35060
y.create.l HWIO_VENUS0_VENUS_VPP_SE_DEC_TOP_COL_TO_LIST0_MAP_1_ADDR A:0x61d35064
y.create.l HWIO_VENUS0_VENUS_VPP_SE_DEC_TOP_COL_TO_LIST0_MAP_2_ADDR A:0x61d35068
y.create.l HWIO_VENUS0_VENUS_VPP_SE_DEC_TOP_SUM_QP_ADDR A:0x61d3506c
y.create.l HWIO_VENUS0_VENUS_VPP_SE_DEC_TOP_SUM_QP_COUNT_ADDR A:0x61d35070
y.create.l HWIO_VENUS0_VENUS_VPP_SE_DEC_TOP_SPARE_1_ADDR A:0x61d35074
y.create.l HWIO_VENUS0_VENUS_VPP_SE_DEC_TOP_REF_POC0_ADDR A:0x61d35078
y.create.l HWIO_VENUS0_VENUS_VPP_SE_DEC_TOP_REF_POC1_ADDR A:0x61d3507c
y.create.l HWIO_VENUS0_VENUS_VPP_SE_DEC_TOP_REF_POC2_ADDR A:0x61d35080
y.create.l HWIO_VENUS0_VENUS_VPP_SE_DEC_TOP_REF_POC3_ADDR A:0x61d35084
y.create.l HWIO_VENUS0_VENUS_VPP_SE_DEC_TOP_REF_POC4_ADDR A:0x61d35088
y.create.l HWIO_VENUS0_VENUS_VPP_SE_DEC_TOP_REF_POC5_ADDR A:0x61d3508c
y.create.l HWIO_VENUS0_VENUS_VPP_SE_DEC_TOP_REF_POC6_ADDR A:0x61d35090
y.create.l HWIO_VENUS0_VENUS_VPP_SE_DEC_TOP_REF_POC7_ADDR A:0x61d35094
y.create.l HWIO_VENUS0_VENUS_VPP_SE_DEC_TOP_REF_POC8_ADDR A:0x61d35098
y.create.l HWIO_VENUS0_VENUS_VPP_SE_DEC_TOP_REF_POC9_ADDR A:0x61d3509c
y.create.l HWIO_VENUS0_VENUS_VPP_SE_DEC_TOP_SCALING_LIST_4X4_CFG_ADDR A:0x61d350f8
y.create.l HWIO_VENUS0_VENUS_VPP_SE_DEC_TOP_SCALING_LIST_8X8_CFG_ADDR A:0x61d350fc
y.create.l HWIO_VENUS0_VENUS_VPP_SE_DEC_TOP_SCALING_LIST_16X16_32X32_CFG_ADDR A:0x61d35100
y.create.l HWIO_VENUS0_VENUS_VPP_SE_DEC_TOP_TILE_INIT_ADDR A:0x61d35104
y.create.l HWIO_VENUS0_VENUS_VPP_SE_DEC_TOP_TILE_POS_X_ADDR A:0x61d35108
y.create.l HWIO_VENUS0_VENUS_VPP_SE_DEC_TOP_TILE_POS_Y_ADDR A:0x61d3510c
y.create.l HWIO_VENUS0_VENUS_VPP_SE_DEC_TOP_ERR_CFG_ADDR A:0x61d35110
y.create.l HWIO_VENUS0_VENUS_VPP_SE_DEC_TOP_ERR_STATUS_ADDR A:0x61d35114
y.create.l HWIO_VENUS0_VENUS_VPP_SE_DEC_TOP_IRQ_STATUS_ADDR A:0x61d35118
y.create.l HWIO_VENUS0_VENUS_VPP_SE_DEC_TOP_STATUS_CLEAR_ADDR A:0x61d3511c
y.create.l HWIO_VENUS0_VENUS_VPP_SE_DEC_TOP_IRQ_MASK_ADDR A:0x61d35120
y.create.l HWIO_VENUS0_VENUS_VPP_SE_DEC_TOP_MB_POS_INFO_1_ADDR A:0x61d35124
y.create.l HWIO_VENUS0_VENUS_VPP_SE_DEC_TOP_MB_POS_INFO_2_ADDR A:0x61d35128
y.create.l HWIO_VENUS0_VENUS_VPP_SE_DEC_TOP_TEST_BUS_CONTROL_ADDR A:0x61d3512c
y.create.l HWIO_VENUS0_VENUS_VPP_SE_DEC_TOP_TEST_BUS_REGISTER_ADDR A:0x61d35130
y.create.l HWIO_VENUS0_VENUS_VPP_SE_DEC_TOP_DEBUG_CFG_ADDR A:0x61d35134
y.create.l HWIO_VENUS0_VENUS_VPP_SE_DEC_TOP_DEBUG_FLUSH_STATUS_ADDR A:0x61d35138
y.create.l HWIO_VENUS0_VENUS_VPP_SE_DEC_TOP_MISR_SPARE0_ADDR A:0x61d3513c
y.create.l HWIO_VENUS0_VENUS_VPP_SE_DEC_TOP_MISR_SPARE1_ADDR A:0x61d35140
y.create.l HWIO_VENUS0_VENUS_VPP_SE_DEC_TOP_MISR_SPARE2_ADDR A:0x61d35144
y.create.l HWIO_VENUS0_VENUS_VPP_SE_DEC_TOP_MISR_SPARE3_ADDR A:0x61d35148
y.create.l HWIO_VENUS0_VENUS_VPP_SE_DEC_TOP_MISR_SPARE4_ADDR A:0x61d3514c
y.create.l HWIO_VENUS0_VENUS_VPP_SE_DEC_TOP_MISR_SPARE5_ADDR A:0x61d35150
y.create.l HWIO_VENUS0_VENUS_VPP_SE_DEC_TOP_MISR_SPARE6_ADDR A:0x61d35154
y.create.l HWIO_VENUS0_VENUS_VPP_SE_DEC_TOP_MISR_SPARE7_ADDR A:0x61d35158
y.create.l HWIO_VENUS0_VENUS_VPP_SE_DEC_TOP_MISR_SPARE8_ADDR A:0x61d3515c
y.create.l HWIO_VENUS0_VENUS_VPP_SE_DEC_TOP_MISR_SPARE9_ADDR A:0x61d35160
y.create.l HWIO_VENUS0_VENUS_VPP_SE_DEC_TOP_SINGLE_STEP_CONTROL_ADDR A:0x61d35168
y.create.l HWIO_VENUS0_VENUS_VPP_SE_DEC_TOP_COL_ADDR_ADDR A:0x61d3516c
y.create.l HWIO_VENUS0_VENUS_VPP_SE_DEC_H265D_CONFIG1_ADDR A:0x61d35200
y.create.l HWIO_VENUS0_VENUS_VPP_SE_DEC_H265D_CONFIG2_ADDR A:0x61d35204
y.create.l HWIO_VENUS0_VENUS_VPP_SE_DEC_H265D_CONFIG3_ADDR A:0x61d35208
y.create.l HWIO_VENUS0_VENUS_VPP_SE_DEC_H265D_CONFIG4_ADDR A:0x61d3520c
y.create.l HWIO_VENUS0_VENUS_VPP_SE_DEC_VC1D_PIC_INFO_ADDR A:0x61d35300
y.create.l HWIO_VENUS0_VENUS_VPP_SE_DEC_VC1D_PIC_TBL_IDX_ADDR A:0x61d35304
y.create.l HWIO_VENUS0_VENUS_VPP_SE_DEC_VC1D_PIC_QUANT_ADDR A:0x61d35308
y.create.l HWIO_VENUS0_VENUS_VPP_SE_DEC_VC1D_PIC_MV_PARAMS_ADDR A:0x61d3530c
y.create.l HWIO_VENUS0_VENUS_VSP_SE_VC1D_PIC_INFO_BITS_ADDR A:0x61d35400
y.create.l HWIO_VENUS0_VENUS_VSP_SE_VC1D_FIELD_INFO_BITS_ADDR A:0x61d35404
y.create.l HWIO_VENUS0_VENUS_VSP_SE_VC1D_BPD_INFO_ADDR A:0x61d35408
y.create.l HWIO_VENUS0_VENUS_VSP_SE_VC1D_BPD_INFO_2_ADDR A:0x61d3540c
y.create.l HWIO_VENUS0_VENUS_VPP_SE_DEC_H264D_SE_CONFIG_ADDR A:0x61d35410
y.create.l HWIO_VENUS0_VENUS_VPP_SE_DEC_MPEG2D_SE_CONFIG_ADDR A:0x61d35500
y.create.l HWIO_VENUS0_VENUS_VPP_SE_DEC_311D_PIC_INFO_ADDR A:0x61d35504
y.create.l HWIO_VENUS0_VENUS_VPP_SE_DEC_MP4D_PIC_INFO_ADDR A:0x61d35508
y.create.l HWIO_VENUS0_VENUS_VPP_SE_DEC_MP4D_COLOCATED0_ADDR A:0x61d3550c
y.create.l HWIO_VENUS0_VENUS_VPP_SE_DEC_MP4D_COLOCATED1_ADDR A:0x61d35600
y.create.l HWIO_VENUS0_VENUS_VPP_SE_DEC_MP4D_COLOCATED2_ADDR A:0x61d35604
y.create.l HWIO_VENUS0_VENUS_VPP_SE_DEC_MP4D_COLOCATED3_ADDR A:0x61d35608
y.create.l HWIO_VENUS0_VENUS_VPP_SE_DEC_MP4D_BITS_ADDR A:0x61d3560c
y.create.l HWIO_VENUS0_VENUS_VPP_SE_DEC_H263D_GOB_INFO_ADDR A:0x61d35700
y.create.l HWIO_VENUS0_VENUS_VPP_SE_DEC_VP9_CFG_0_ADDR A:0x61d35704
y.create.l HWIO_VENUS0_VENUS_VPP_SE_DEC_VPX_SLF0_ADDR A:0x61d35708
y.create.l HWIO_VENUS0_VENUS_VPP_SE_DEC_VPX_SLF1_ADDR A:0x61d3570c
y.create.l HWIO_VENUS0_VENUS_VPP_SE_DEC_VPX_SLF2_ADDR A:0x61d35710
y.create.l HWIO_VENUS0_VENUS_VPP_SE_DEC_VPX_SLF3_ADDR A:0x61d35714
y.create.l HWIO_VENUS0_VENUS_VPP_SE_DEC_VPX_SLF4_ADDR A:0x61d35718
y.create.l HWIO_VENUS0_VENUS_VPP_SE_DEC_VPX_SLF5_ADDR A:0x61d3571c
y.create.l HWIO_VENUS0_VENUS_VPP_SE_DEC_VPX_SLF6_ADDR A:0x61d35720
y.create.l HWIO_VENUS0_VENUS_VPP_SE_DEC_VPX_SLF7_ADDR A:0x61d35724
y.create.l HWIO_VENUS0_VENUS_VPP_SE_DEC_VPX_SLF_READ0_ADDR A:0x61d35728
y.create.l HWIO_VENUS0_VENUS_VPP_SE_DEC_VPX_SLF_READ1_ADDR A:0x61d3572c
y.create.l HWIO_VENUS0_VENUS_VPP_SE_DEC_VPX_SLF_READ2_ADDR A:0x61d35730
y.create.l HWIO_VENUS0_VENUS_VPP_SE_DEC_VPX_SLF_READ3_ADDR A:0x61d35734
y.create.l HWIO_VENUS0_VENUS_VPP_SE_DEC_VPX_SLF_READ4_ADDR A:0x61d35738
y.create.l HWIO_VENUS0_VENUS_VPP_SE_DEC_VPX_SLF_READ5_ADDR A:0x61d3573c
y.create.l HWIO_VENUS0_VENUS_VPP_SE_DEC_VPX_SLF_READ6_ADDR A:0x61d35740
y.create.l HWIO_VENUS0_VENUS_VPP_SE_DEC_VPX_SLF_READ7_ADDR A:0x61d35744
y.create.l HWIO_VENUS0_VENUS_VPP_SE_DEC_SPARE_0_ADDR A:0x61d35748
y.create.l HWIO_VENUS0_VENUS_VPP_SE_DEC_SPARE_1_ADDR A:0x61d3574c
y.create.l HWIO_VENUS0_VENUS_VPP_PE_DEC_PIC_SIZE_ADDR A:0x61d36000
y.create.l HWIO_VENUS0_VENUS_VPP_PE_DEC_PIC_CFG_ADDR A:0x61d36004
y.create.l HWIO_VENUS0_VENUS_VPP_PE_DEC_REF_BYTES_PER_LINE_ADDR A:0x61d36008
y.create.l HWIO_VENUS0_VENUS_VPP_PE_DEC_FRAME_CONTROL_ADDR A:0x61d3600c
y.create.l HWIO_VENUS0_VENUS_VPP_PE_DEC_VC1_IC_RD_CTRL_ADDR A:0x61d36010
y.create.l HWIO_VENUS0_VENUS_VPP_PE_DEC_VC1_IC_CUR_TOP_ADDR A:0x61d36014
y.create.l HWIO_VENUS0_VENUS_VPP_PE_DEC_VC1_IC_CUR_BOT_ADDR A:0x61d36018
y.create.l HWIO_VENUS0_VENUS_VPP_PE_DEC_VC1_IC_FR_TOP_ADDR A:0x61d3601c
y.create.l HWIO_VENUS0_VENUS_VPP_PE_DEC_VC1_IC_FR_BOT_ADDR A:0x61d36020
y.create.l HWIO_VENUS0_VENUS_VPP_PE_DEC_VC1_IC_BR_ADDR A:0x61d36024
y.create.l HWIO_VENUS0_VENUS_VPP_PE_DEC_VP9_SCALE_FACTOR_ADDR A:0x61d36028
y.create.l HWIO_VENUS0_VENUS_VPP_PE_DEC_IRQ_MASK_ADDR A:0x61d3602c
y.create.l HWIO_VENUS0_VENUS_VPP_PE_DEC_IRQ_STATUS_ADDR A:0x61d36030
y.create.l HWIO_VENUS0_VENUS_VPP_PE_DEC_IRQ_CLEAR_ADDR A:0x61d36034
y.create.l HWIO_VENUS0_VENUS_VPP_PE_DEC_ERR_CFG1_ADDR A:0x61d36038
y.create.l HWIO_VENUS0_VENUS_VPP_PE_DEC_DEBUG_CFG_ADDR A:0x61d3603c
y.create.l HWIO_VENUS0_VENUS_VPP_PE_DEC_MISR_RESET_ADDR A:0x61d36040
y.create.l HWIO_VENUS0_VENUS_VPP_PE_DEC_MISR_ENABLE_ADDR A:0x61d36044
y.create.l HWIO_VENUS0_VENUS_VPP_PE_DEC_MISR_PE2FE_VAL_0_ADDR A:0x61d36048
y.create.l HWIO_VENUS0_VENUS_VPP_PE_DEC_TEST_BUS_CONTROL_ADDR A:0x61d3604c
y.create.l HWIO_VENUS0_VENUS_VPP_PE_DEC_TEST_BUS_REGISTER_ADDR A:0x61d36050
y.create.l HWIO_VENUS0_VENUS_VPP_PE_DEC_MISR_PE2FE_VAL_1_ADDR A:0x61d36054
y.create.l HWIO_VENUS0_VENUS_VPP_PE_DEC_MISR_PE2FE_VAL_2_ADDR A:0x61d36058
y.create.l HWIO_VENUS0_VENUS_VPP_PE_DEC_MISR_PE2FE_VAL_3_ADDR A:0x61d3605c
y.create.l HWIO_VENUS0_VENUS_VPP_PE_DEC_MISR_SE2TPRED_VAL_0_ADDR A:0x61d36060
y.create.l HWIO_VENUS0_VENUS_VPP_PE_DEC_MISR_SE2TPRED_VAL_1_ADDR A:0x61d36064
y.create.l HWIO_VENUS0_VENUS_VPP_PE_DEC_MISR_SE2SPRED_VAL_0_ADDR A:0x61d36068
y.create.l HWIO_VENUS0_VENUS_VPP_PE_DEC_MISR_SE2SPRED_VAL_1_ADDR A:0x61d3606c
y.create.l HWIO_VENUS0_VENUS_VPP_PE_DEC_SPARE_0_ADDR A:0x61d36070
y.create.l HWIO_VENUS0_VENUS_VPP_TE_DEC_PIC_CFG_ADDR A:0x61d37000
y.create.l HWIO_VENUS0_VENUS_VPP_TE_DEC_STATUS_ADDR A:0x61d37008
y.create.l HWIO_VENUS0_VENUS_VPP_TE_DEC_SPARE_ADDR A:0x61d3700c
y.create.l HWIO_VENUS0_VENUS_VPP_TE_DEC_SW_RESET_ADDR A:0x61d37010
y.create.l HWIO_VENUS0_VENUS_VPP_TE_DEC_IRQ_MASK_ADDR A:0x61d37014
y.create.l HWIO_VENUS0_VENUS_VPP_TE_DEC_IRQ_STATUS_ADDR A:0x61d37018
y.create.l HWIO_VENUS0_VENUS_VPP_TE_DEC_IRQ_CLEAR_ADDR A:0x61d3701c
y.create.l HWIO_VENUS0_VENUS_VPP_TE_DEC_MISR_RESET_ADDR A:0x61d37020
y.create.l HWIO_VENUS0_VENUS_VPP_TE_DEC_MISR_ENABLE_ADDR A:0x61d37024
y.create.l HWIO_VENUS0_VENUS_VPP_TE_DEC_MISR_TE2PE_VAL_0_ADDR A:0x61d37028
y.create.l HWIO_VENUS0_VENUS_VPP_TE_DEC_MISR_TE2PE_VAL_1_ADDR A:0x61d3702c
y.create.l HWIO_VENUS0_VENUS_VPP_TE_DEC_TEST_BUS_CONTROL_ADDR A:0x61d37030
y.create.l HWIO_VENUS0_VENUS_VPP_TE_DEC_TEST_BUS_REGISTER_ADDR A:0x61d37034
y.create.l HWIO_VENUS0_VENUS_VPP_TE_DEC_MISR_TE2PE_VAL_2_ADDR A:0x61d37038
y.create.l HWIO_VENUS0_VENUS_VPP_TE_DEC_MISR_SE2TE_VAL_0_ADDR A:0x61d3703c
y.create.l HWIO_VENUS0_VENUS_VPP_TE_DEC_MISR_SE2TE_VAL_1_ADDR A:0x61d37040
y.create.l HWIO_VENUS0_VENUS_VPP_TE_DEC_MISR_SE2TE_VAL_2_ADDR A:0x61d37044
y.create.l HWIO_VENUS0_VENUS_VPP_TE_DEC_SPARE_1_ADDR A:0x61d37048
y.create.l HWIO_VENUS0_VENUS_VPP_FE_DEC_PIC_CFG_ADDR A:0x61d38000
y.create.l HWIO_VENUS0_VENUS_VPP_FE_DEC_PIC_SIZE_ADDR A:0x61d38004
y.create.l HWIO_VENUS0_VENUS_VPP_FE_DEC_REF_BYTES_PER_LINE_ADDR A:0x61d38008
y.create.l HWIO_VENUS0_VENUS_VPP_FE_DEC_CODEC_CONFIG_ADDR A:0x61d3800c
y.create.l HWIO_VENUS0_VENUS_VPP_FE_DEC_STATUS_ADDR A:0x61d38010
y.create.l HWIO_VENUS0_VENUS_VPP_FE_DEC_IRQ_MASK_ADDR A:0x61d38014
y.create.l HWIO_VENUS0_VENUS_VPP_FE_DEC_IRQ_STATUS_ADDR A:0x61d38018
y.create.l HWIO_VENUS0_VENUS_VPP_FE_DEC_IRQ_CLEAR_ADDR A:0x61d3801c
y.create.l HWIO_VENUS0_VENUS_VPP_FE_DEC_TEST_BUS_CONTROL_ADDR A:0x61d38020
y.create.l HWIO_VENUS0_VENUS_VPP_FE_DEC_TEST_BUS_REGISTER_ADDR A:0x61d38024
y.create.l HWIO_VENUS0_VENUS_VPP_FE_DEC_MISR_RESET_ADDR A:0x61d38028
y.create.l HWIO_VENUS0_VENUS_VPP_FE_DEC_MISR_ENABLE_ADDR A:0x61d3802c
y.create.l HWIO_VENUS0_VENUS_VPP_FE_DEC_MISR_SE2FE_VAL_0_ADDR A:0x61d38030
y.create.l HWIO_VENUS0_VENUS_VPP_FE_DEC_MISR_SE2FE_VAL_1_ADDR A:0x61d38034
y.create.l HWIO_VENUS0_VENUS_VPP_FE_DEC_MISR_SE2FE_VAL_2_ADDR A:0x61d38038
y.create.l HWIO_VENUS0_VENUS_VPP_FE_DEC_MISR_SE2FE_VAL_3_ADDR A:0x61d3803c
y.create.l HWIO_VENUS0_VENUS_VPP_FE_DEC_MISR_SE2FE_VAL_4_ADDR A:0x61d38040
y.create.l HWIO_VENUS0_VENUS_VPP_FE_DEC_SPARE_0_ADDR A:0x61d38044
y.create.l HWIO_VENUS0_VENUS_DMA_DEC_CONFIG_ADDR A:0x61d3f000
y.create.l HWIO_VENUS0_VENUS_DMA_DEC_OPB_CFG_ADDR A:0x61d3f004
y.create.l HWIO_VENUS0_VENUS_DMA_DEC_DPB_CFG_ADDR A:0x61d3f008
y.create.l HWIO_VENUS0_VENUS_DMA_DEC_L1_CFG_ADDR A:0x61d3f00c
y.create.l HWIO_VENUS0_VENUS_DMA_DEC_L1C_STAT0_ADDR A:0x61d3f010
y.create.l HWIO_VENUS0_VENUS_DMA_DEC_L1C_STAT1_ADDR A:0x61d3f014
y.create.l HWIO_VENUS0_VENUS_DMA_DEC_L1C_STAT2_ADDR A:0x61d3f018
y.create.l HWIO_VENUS0_VENUS_DMA_DEC_L1C_STAT3_ADDR A:0x61d3f01c
y.create.l HWIO_VENUS0_VENUS_DMA_DEC_L1C_STAT4_ADDR A:0x61d3f020
y.create.l HWIO_VENUS0_VENUS_DMA_DEC_L1C_STAT5_ADDR A:0x61d3f024
y.create.l HWIO_VENUS0_VENUS_DMA_DEC_L1C_STAT6_ADDR A:0x61d3f028
y.create.l HWIO_VENUS0_VENUS_DMA_DEC_L1C_STAT7_ADDR A:0x61d3f02c
y.create.l HWIO_VENUS0_VENUS_DMA_DEC_L1C_STAT8_ADDR A:0x61d3f030
y.create.l HWIO_VENUS0_VENUS_DMA_DEC_L1C_STAT9_ADDR A:0x61d3f034
y.create.l HWIO_VENUS0_VENUS_DMA_DEC_CACHE_RESET_ADDR A:0x61d3f050
y.create.l HWIO_VENUS0_VENUS_DMA_DEC_UBWC_STATUS_ADDR A:0x61d3f054
y.create.l HWIO_VENUS0_VENUS_DMA_DEC_LB_DEST_ADDR A:0x61d3f100
y.create.l HWIO_VENUS0_VENUS_DMA_DEC_WB_REF_FRAME_SIZE_ADDR A:0x61d3f104
y.create.l HWIO_VENUS0_VENUS_DMA_DEC_WB_REC_FRAME_SIZE_ADDR A:0x61d3f108
y.create.l HWIO_VENUS0_VENUS_DMA_DEC_REF_BYTES_PER_LINE_ADDR A:0x61d3f10c
y.create.l HWIO_VENUS0_VENUS_DMA_DEC_DS_BYTES_PER_LINE_ADDR A:0x61d3f110
y.create.l HWIO_VENUS0_VENUS_DMA_DEC_VSP_LB_DEST_ADDR A:0x61d3f114
y.create.l HWIO_VENUS0_VENUS_DMA_DEC_DS_FRAME_SIZE_ADDR A:0x61d3f118
y.create.l HWIO_VENUS0_VENUS_DMA_DEC_BUFF_START_ADDR0_ADDR A:0x61d3f200
y.create.l HWIO_VENUS0_VENUS_DMA_DEC_BUFF_START_ADDR1_ADDR A:0x61d3f204
y.create.l HWIO_VENUS0_VENUS_DMA_DEC_BUFF_START_ADDR2_ADDR A:0x61d3f208
y.create.l HWIO_VENUS0_VENUS_DMA_DEC_BUFF_START_ADDR3_ADDR A:0x61d3f20c
y.create.l HWIO_VENUS0_VENUS_DMA_DEC_BUFF_START_ADDR4_ADDR A:0x61d3f210
y.create.l HWIO_VENUS0_VENUS_DMA_DEC_BUFF_START_ADDR5_ADDR A:0x61d3f214
y.create.l HWIO_VENUS0_VENUS_DMA_DEC_BUFF_START_ADDR6_ADDR A:0x61d3f218
y.create.l HWIO_VENUS0_VENUS_DMA_DEC_BUFF_START_ADDR7_ADDR A:0x61d3f21c
y.create.l HWIO_VENUS0_VENUS_DMA_DEC_BUFF_START_ADDR8_ADDR A:0x61d3f220
y.create.l HWIO_VENUS0_VENUS_DMA_DEC_BUFF_START_ADDR9_ADDR A:0x61d3f224
y.create.l HWIO_VENUS0_VENUS_DMA_DEC_BUFF_SSID0_ADDR A:0x61d3f400
y.create.l HWIO_VENUS0_VENUS_DMA_DEC_BUFF_SSID1_ADDR A:0x61d3f404
y.create.l HWIO_VENUS0_VENUS_DMA_DEC_BUFF_SSID2_ADDR A:0x61d3f408
y.create.l HWIO_VENUS0_VENUS_DMA_DEC_BUFF_SSID3_ADDR A:0x61d3f40c
y.create.l HWIO_VENUS0_VENUS_DMA_DEC_BUFF_SSID4_ADDR A:0x61d3f410
y.create.l HWIO_VENUS0_VENUS_DMA_DEC_BUFF_SSID5_ADDR A:0x61d3f414
y.create.l HWIO_VENUS0_VENUS_DMA_DEC_BUFF_SSID6_ADDR A:0x61d3f418
y.create.l HWIO_VENUS0_VENUS_DMA_DEC_BUFF_SSID7_ADDR A:0x61d3f41c
y.create.l HWIO_VENUS0_VENUS_DMA_DEC_BUFF_SSID8_ADDR A:0x61d3f420
y.create.l HWIO_VENUS0_VENUS_DMA_DEC_BUFF_SSID9_ADDR A:0x61d3f424
y.create.l HWIO_VENUS0_VENUS_DMA_DEC_L2_CFG_ADDR A:0x61d3f500
y.create.l HWIO_VENUS0_VENUS_DMA_DEC_L2_START_ADDR_ADDR A:0x61d3f504
y.create.l HWIO_VENUS0_VENUS_DMA_DEC_L2C_STAT0_ADDR A:0x61d3f510
y.create.l HWIO_VENUS0_VENUS_DMA_DEC_L2C_STAT1_ADDR A:0x61d3f514
y.create.l HWIO_VENUS0_VENUS_DMA_DEC_L2C_STAT2_ADDR A:0x61d3f518
y.create.l HWIO_VENUS0_VENUS_DMA_DEC_L2C_STAT3_ADDR A:0x61d3f51c
y.create.l HWIO_VENUS0_VENUS_DMA_DEC_L2C_STAT4_ADDR A:0x61d3f520
y.create.l HWIO_VENUS0_VENUS_DMA_DEC_L2C_STAT5_ADDR A:0x61d3f524
y.create.l HWIO_VENUS0_VENUS_DMA_DEC_L2C_STAT6_ADDR A:0x61d3f528
y.create.l HWIO_VENUS0_VENUS_DMA_DEC_L2C_STAT7_ADDR A:0x61d3f52c
y.create.l HWIO_VENUS0_VENUS_DMA_DEC_L2C_STAT8_ADDR A:0x61d3f530
y.create.l HWIO_VENUS0_VENUS_DMA_DEC_L2C_STAT9_ADDR A:0x61d3f534
y.create.l HWIO_VENUS0_VENUS_DMA_DEC_DYN_SEL_CTRL_ADDR A:0x61d3f600
y.create.l HWIO_VENUS0_VENUS_DMA_DEC_MV_BIN_CNT0_ADDR A:0x61d3f604
y.create.l HWIO_VENUS0_VENUS_DMA_DEC_MV_BIN_CNT1_ADDR A:0x61d3f608
y.create.l HWIO_VENUS0_VENUS_DMA_DEC_MV_BIN_CNT2_ADDR A:0x61d3f60c
y.create.l HWIO_VENUS0_VENUS_DMA_DEC_MV_BIN_CNT3_ADDR A:0x61d3f610
y.create.l HWIO_VENUS0_VENUS_DMA_DEC_MV_BIN_CNT4_ADDR A:0x61d3f614
y.create.l HWIO_VENUS0_VENUS_DMA_DEC_MV_BIN_CNT5_ADDR A:0x61d3f618
y.create.l HWIO_VENUS0_VENUS_DMA_DEC_MV_BIN_CNT6_ADDR A:0x61d3f61c
y.create.l HWIO_VENUS0_VENUS_DMA_DEC_MV_BIN_CNT7_ADDR A:0x61d3f620
y.create.l HWIO_VENUS0_VENUS_DMA_DEC_MV_BIN_CNT8_ADDR A:0x61d3f624
y.create.l HWIO_VENUS0_VENUS_DMA_DEC_MV_BIN_CNT9_ADDR A:0x61d3f628
y.create.l HWIO_VENUS0_VENUS_DMA_DEC_LCU_CNT_ADDR A:0x61d3f684
y.create.l HWIO_VENUS0_VENUS_DMA_DOM_IDX_ADDR A:0x61d3f688
y.create.l HWIO_VENUS0_VENUS_DMA_DEC_L1_DOM_IDX_ADDR A:0x61d3f68c
y.create.l HWIO_VENUS0_VENUS_DMA_DEC_MISR_RESET_ADDR A:0x61d3f700
y.create.l HWIO_VENUS0_VENUS_DMA_DEC_MISR_ENABLE_ADDR A:0x61d3f704
y.create.l HWIO_VENUS0_VENUS_DMA_DEC_MISR_FE2DMA_RECON_VAL_0_ADDR A:0x61d3f708
y.create.l HWIO_VENUS0_VENUS_DMA_DEC_MISR_FE2DMA_RECON_VAL_1_ADDR A:0x61d3f70c
y.create.l HWIO_VENUS0_VENUS_DMA_DEC_MISR_FE2DMA_RECON_VAL_2_ADDR A:0x61d3f710
y.create.l HWIO_VENUS0_VENUS_DMA_DEC_MISR_PPE2DMA_RECON_VAL_0_ADDR A:0x61d3f714
y.create.l HWIO_VENUS0_VENUS_DMA_DEC_MISR_PPE2DMA_RECON_VAL_1_ADDR A:0x61d3f718
y.create.l HWIO_VENUS0_VENUS_DMA_DEC_MISR_PPE2DMA_RECON_VAL_2_ADDR A:0x61d3f71c
y.create.l HWIO_VENUS0_VENUS_DMA_DEC_MISR_CCE2DMA_VAL_0_ADDR A:0x61d3f720
y.create.l HWIO_VENUS0_VENUS_DMA_DEC_MISR_CCE2DMA_VAL_1_ADDR A:0x61d3f724
y.create.l HWIO_VENUS0_VENUS_DMA_DEC_MISR_CCE2DMA_VAL_2_ADDR A:0x61d3f728
y.create.l HWIO_VENUS0_VENUS_DMA_DEC_MISR_CCE2DMA_VAL_3_ADDR A:0x61d3f72c
y.create.l HWIO_VENUS0_VENUS_DMA_DEC_MISR_CCE2DMA_VAL_4_ADDR A:0x61d3f730
y.create.l HWIO_VENUS0_VENUS_DMA_DEC_MISR_FE2DMA_LBUF_VAL_0_ADDR A:0x61d3f734
y.create.l HWIO_VENUS0_VENUS_DMA_DEC_L1C_STAT_LOAD_ADDR A:0x61d3f738
y.create.l HWIO_VENUS0_VENUS_DMA_DEC_L2C_STAT_LOAD_ADDR A:0x61d3f73c
y.create.l HWIO_VENUS0_VENUS_DMA_DEC_MV_BIN_CNT_LOAD_ADDR A:0x61d3f740
y.create.l HWIO_VENUS0_VENUS_DMA_DEC_LCU_CNT_LOAD_ADDR A:0x61d3f744
y.create.l HWIO_VENUS0_VENUS_DMA_DEC_DOM_IDX_LOAD_ADDR A:0x61d3f748
y.create.l HWIO_VENUS0_VENUS_DMA_DEC_TEST_BUS_CONTROL_ADDR A:0x61d3f74c
y.create.l HWIO_VENUS0_VENUS_DMA_DEC_TEST_BUS_REGISTER_ADDR A:0x61d3f750
y.create.l HWIO_VENUS0_VENUS_DMA_DEC_STATUS_REGISTER_ADDR A:0x61d3f754
y.create.l HWIO_VENUS0_VENUS_DMA_DEC_META_DATA_REF_LUMA_START_INIT_ADDR A:0x61d3f800
y.create.l HWIO_VENUS0_VENUS_DMA_DEC_META_DATA_REF_LUMA_START_ADDR_ADDR A:0x61d3f804
y.create.l HWIO_VENUS0_VENUS_DMA_DEC_META_DATA_REF_CHROMA_START_INIT_ADDR A:0x61d3f808
y.create.l HWIO_VENUS0_VENUS_DMA_DEC_META_DATA_REF_CHROMA_START_ADDR_ADDR A:0x61d3f80c
y.create.l HWIO_VENUS0_VENUS_DMA_DEC_SDE_BIT_BUF_START_INIT_ADDR A:0x61d3f810
y.create.l HWIO_VENUS0_VENUS_DMA_DEC_SDE_BIT_BUF_START_ADDR_ADDR A:0x61d3f814
y.create.l HWIO_VENUS0_VENUS_DMA_DEC_SDE_BIN_BUF_START_INIT_ADDR A:0x61d3f818
y.create.l HWIO_VENUS0_VENUS_DMA_DEC_SDE_BIN_BUF_START_ADDR_ADDR A:0x61d3f81c
y.create.l HWIO_VENUS0_VENUS_DMA_DEC_SE_BIN_BUF_START_INIT_ADDR A:0x61d3f820
y.create.l HWIO_VENUS0_VENUS_DMA_DEC_SE_BIN_BUF_START_ADDR_ADDR A:0x61d3f824
y.create.l HWIO_VENUS0_VENUS_DMA_DEC_REF_FRAME_ADDR_LUMA_START_INIT_ADDR A:0x61d3f828
y.create.l HWIO_VENUS0_VENUS_DMA_DEC_REF_FRAME_LUMA_START_ADDR_ADDR A:0x61d3f82c
y.create.l HWIO_VENUS0_VENUS_DMA_DEC_REF_FRAME_CHROMA_ADDR_START_INIT_ADDR A:0x61d3f830
y.create.l HWIO_VENUS0_VENUS_DMA_DEC_REF_FRAME_CHROMA_START_ADDR_ADDR A:0x61d3f834
y.create.l HWIO_VENUS0_VENUS_DMA_DEC_MISR_FE2DMA_LBUF_VAL_1_ADDR A:0x61d3f838
y.create.l HWIO_VENUS0_VENUS_DMA_DEC_MISR_FE2DMA_LBUF_VAL_2_ADDR A:0x61d3f83c
y.create.l HWIO_VENUS0_VENUS_DMA_DEC_MISR_FE2DMA_LBUF_VAL_3_ADDR A:0x61d3f840
y.create.l HWIO_VENUS0_VENUS_DMA_DEC_MISR_FE2DMA_LBUF_VAL_4_ADDR A:0x61d3f844
y.create.l HWIO_VENUS0_VENUS_DMA_DEC_MISR_SDE2DMA_VAL_0_ADDR A:0x61d3f848
y.create.l HWIO_VENUS0_VENUS_DMA_DEC_MISR_SDE2DMA_VAL_1_ADDR A:0x61d3f84c
y.create.l HWIO_VENUS0_VENUS_DMA_DEC_MISR_SDE2DMA_VAL_2_ADDR A:0x61d3f850
y.create.l HWIO_VENUS0_VENUS_DMA_DEC_MISR_SDE2DMA_VAL_3_ADDR A:0x61d3f854
y.create.l HWIO_VENUS0_VENUS_DMA_DEC_MISR_SDE2DMA_VAL_4_ADDR A:0x61d3f858
y.create.l HWIO_VENUS0_VENUS_DMA_DEC_MISR_PPE2DMA_LBUF_VAL_0_ADDR A:0x61d3f85c
y.create.l HWIO_VENUS0_VENUS_DMA_DEC_MISR_PPE2DMA_LBUF_VAL_1_ADDR A:0x61d3f860
y.create.l HWIO_VENUS0_VENUS_DMA_DEC_MISR_PPE2DMA_LBUF_VAL_2_ADDR A:0x61d3f864
y.create.l HWIO_VENUS0_VENUS_DMA_DEC_MISR_PPE2DMA_LBUF_VAL_3_ADDR A:0x61d3f868
y.create.l HWIO_VENUS0_VENUS_DMA_DEC_MISR_PPE2DMA_LBUF_VAL_4_ADDR A:0x61d3f86c
y.create.l HWIO_VENUS0_VENUS_DMA_DEC_REC_BYTES_PER_LINE_ADDR A:0x61d3f870
y.create.l HWIO_VENUS0_VENUS_DMA_DEC_REF1_BYTES_PER_LINE_ADDR A:0x61d3f874
y.create.l HWIO_VENUS0_VENUS_DMA_DEC_REF2_BYTES_PER_LINE_ADDR A:0x61d3f878
y.create.l HWIO_VENUS0_VENUS_DMA_DEC_SPARE_3_ADDR A:0x61d3f87c
y.create.l HWIO_VENUS0_VENUS_DMA_DEC_SPARE_4_ADDR A:0x61d3f880
y.create.l HWIO_VENUS0_VENUS_DMA_DEC_SPARE_5_ADDR A:0x61d3f884
y.create.l HWIO_VENUS0_VENUS_DMA_DEC_SPARE_6_ADDR A:0x61d3f888
y.create.l HWIO_VENUS0_VENUS_DMA_DEC_SPARE_7_ADDR A:0x61d3f88c
y.create.l HWIO_VENUS0_VENUS_CPU_WD_WDOGLOAD_ADDR A:0x61dc1000
y.create.l HWIO_VENUS0_VENUS_CPU_WD_WDOGVALUE_ADDR A:0x61dc1004
y.create.l HWIO_VENUS0_VENUS_CPU_WD_WDOGCONTROL_ADDR A:0x61dc1008
y.create.l HWIO_VENUS0_VENUS_CPU_WD_WDOGINTCLR_ADDR A:0x61dc100c
y.create.l HWIO_VENUS0_VENUS_CPU_WD_WDOGRIS_ADDR A:0x61dc1010
y.create.l HWIO_VENUS0_VENUS_CPU_WD_WDOGMIS_ADDR A:0x61dc1014
y.create.l HWIO_VENUS0_VENUS_CPU_WD_WDOGLOCK_ADDR A:0x61dc1c00
y.create.l HWIO_VENUS0_VENUS_CPU_WD_WDOGITCR_ADDR A:0x61dc1f00
y.create.l HWIO_VENUS0_VENUS_CPU_WD_WDOGITOP_ADDR A:0x61dc1f04
y.create.l HWIO_VENUS0_VENUS_CPU_WD_WDOGPERIPHID0_ADDR A:0x61dc1fe0
y.create.l HWIO_VENUS0_VENUS_CPU_WD_WDOGPERIPHID1_ADDR A:0x61dc1fe4
y.create.l HWIO_VENUS0_VENUS_CPU_WD_WDOGPERIPHID2_ADDR A:0x61dc1fe8
y.create.l HWIO_VENUS0_VENUS_CPU_WD_WDOGPERIPHID3_ADDR A:0x61dc1fec
y.create.l HWIO_VENUS0_VENUS_CPU_WD_WWDOGPCELLID0_ADDR A:0x61dc1ff0
y.create.l HWIO_VENUS0_VENUS_CPU_WD_WDOGPCELLID1_ADDR A:0x61dc1ff4
y.create.l HWIO_VENUS0_VENUS_CPU_WD_WDOGPCELLID2_ADDR A:0x61dc1ff8
y.create.l HWIO_VENUS0_VENUS_CPU_WD_WDOGPCELLID3_ADDR A:0x61dc1ffc
y.create.l HWIO_VENUS0_VENUS_CPU_TM_TIMER1LOAD_ADDR A:0x61dc2000
y.create.l HWIO_VENUS0_VENUS_CPU_TM_TIMER1VALUE_ADDR A:0x61dc2004
y.create.l HWIO_VENUS0_VENUS_CPU_TM_TIMER1CONTROL_ADDR A:0x61dc2008
y.create.l HWIO_VENUS0_VENUS_CPU_TM_TIMER1INTCLR_ADDR A:0x61dc200c
y.create.l HWIO_VENUS0_VENUS_CPU_TM_TIMER1RIS_ADDR A:0x61dc2010
y.create.l HWIO_VENUS0_VENUS_CPU_TM_TIMER1MIS_ADDR A:0x61dc2014
y.create.l HWIO_VENUS0_VENUS_CPU_TM_TIMER1BGLOAD_ADDR A:0x61dc2018
y.create.l HWIO_VENUS0_VENUS_CPU_TM_TIMER2LOAD_ADDR A:0x61dc2020
y.create.l HWIO_VENUS0_VENUS_CPU_TM_TIMER2VALUE_ADDR A:0x61dc2024
y.create.l HWIO_VENUS0_VENUS_CPU_TM_TIMER2CONTROL_ADDR A:0x61dc2028
y.create.l HWIO_VENUS0_VENUS_CPU_TM_TIMER2INTCLR_ADDR A:0x61dc202c
y.create.l HWIO_VENUS0_VENUS_CPU_TM_TIMER2RIS_ADDR A:0x61dc2030
y.create.l HWIO_VENUS0_VENUS_CPU_TM_TIMER2MIS_ADDR A:0x61dc2034
y.create.l HWIO_VENUS0_VENUS_CPU_TM_TIMER2BGLOAD_ADDR A:0x61dc2038
y.create.l HWIO_VENUS0_VENUS_CPU_TM_TIMERITCR_ADDR A:0x61dc2f00
y.create.l HWIO_VENUS0_VENUS_CPU_TM_TIMERITOP_ADDR A:0x61dc2f04
y.create.l HWIO_VENUS0_VENUS_CPU_TM_TIMERPERIPHID0_ADDR A:0x61dc2fe0
y.create.l HWIO_VENUS0_VENUS_CPU_TM_TIMERPERIPHID1_ADDR A:0x61dc2fe4
y.create.l HWIO_VENUS0_VENUS_CPU_TM_TIMERPERIPHID2_ADDR A:0x61dc2fe8
y.create.l HWIO_VENUS0_VENUS_CPU_TM_TIMERPERIPHID3_ADDR A:0x61dc2fec
y.create.l HWIO_VENUS0_VENUS_CPU_TM_TIMERPCELLID0_ADDR A:0x61dc2ff0
y.create.l HWIO_VENUS0_VENUS_CPU_TM_TIMERPCELLID1_ADDR A:0x61dc2ff4
y.create.l HWIO_VENUS0_VENUS_CPU_TM_TIMERPCELLID2_ADDR A:0x61dc2ff8
y.create.l HWIO_VENUS0_VENUS_CPU_TM_TIMERPCELLID3_ADDR A:0x61dc2ffc
y.create.l HWIO_VENUS0_VENUS_CPU_CS_REMAP_ADDR A:0x61dd2000
y.create.l HWIO_VENUS0_VENUS_CPU_CS_TIMERCONTROL_ADDR A:0x61dd2004
y.create.l HWIO_VENUS0_VENUS_CPU_CS_A2HSOFTINTEN_ADDR A:0x61dd2010
y.create.l HWIO_VENUS0_VENUS_CPU_CS_A2HSOFTINTENCLR_ADDR A:0x61dd2014
y.create.l HWIO_VENUS0_VENUS_CPU_CS_A2HSOFTINT_ADDR A:0x61dd2018
y.create.l HWIO_VENUS0_VENUS_CPU_CS_A2HSOFTINTCLR_ADDR A:0x61dd201c
y.create.l HWIO_VENUS0_VENUS_CPU_CS_VCICMD_ADDR A:0x61dd2020
y.create.l HWIO_VENUS0_VENUS_CPU_CS_VCICMDARG0_ADDR A:0x61dd2024
y.create.l HWIO_VENUS0_VENUS_CPU_CS_VCICMDARG1_ADDR A:0x61dd2028
y.create.l HWIO_VENUS0_VENUS_CPU_CS_VCICMDARG2_ADDR A:0x61dd202c
y.create.l HWIO_VENUS0_VENUS_CPU_CS_VCICMDARG3_ADDR A:0x61dd2030
y.create.l HWIO_VENUS0_VENUS_CPU_CS_VMIMSG_ADDR A:0x61dd2034
y.create.l HWIO_VENUS0_VENUS_CPU_CS_VMIMSGAG0_ADDR A:0x61dd2038
y.create.l HWIO_VENUS0_VENUS_CPU_CS_VMIMSGAG1_ADDR A:0x61dd203c
y.create.l HWIO_VENUS0_VENUS_CPU_CS_VMIMSGAG2_ADDR A:0x61dd2040
y.create.l HWIO_VENUS0_VENUS_CPU_CS_VMIMSGAG3_ADDR A:0x61dd2044
y.create.l HWIO_VENUS0_VENUS_CPU_CS_SCIACMD_ADDR A:0x61dd2048
y.create.l HWIO_VENUS0_VENUS_CPU_CS_SCIACMDARG0_ADDR A:0x61dd204c
y.create.l HWIO_VENUS0_VENUS_CPU_CS_SCIACMDARG1_ADDR A:0x61dd2050
y.create.l HWIO_VENUS0_VENUS_CPU_CS_SCIACMDARG2_ADDR A:0x61dd2054
y.create.l HWIO_VENUS0_VENUS_CPU_CS_SCIACMDARG3_ADDR A:0x61dd2058
y.create.l HWIO_VENUS0_VENUS_CPU_CS_SCIBCMD_ADDR A:0x61dd205c
y.create.l HWIO_VENUS0_VENUS_CPU_CS_SCIBCMDARG0_ADDR A:0x61dd2060
y.create.l HWIO_VENUS0_VENUS_CPU_CS_SCIBARG1_ADDR A:0x61dd2064
y.create.l HWIO_VENUS0_VENUS_CPU_CS_SCIBARG2_ADDR A:0x61dd2068
y.create.l HWIO_VENUS0_VENUS_CPU_CS_SCIBARG3_ADDR A:0x61dd206c
y.create.l HWIO_VENUS0_VENUS_CPU_CS_DEBUGSEL_ADDR A:0x61dd2070
y.create.l HWIO_VENUS0_VENUS_CPU_CS_MASTER0_CONFIG_ADDR A:0x61dd2074
y.create.l HWIO_VENUS0_VENUS_CPU_CS_MASTER0_MASK_ADDR A:0x61dd2078
y.create.l HWIO_VENUS0_VENUS_CPU_CS_MASTER0_MATCH_ADDR A:0x61dd207c
y.create.l HWIO_VENUS0_VENUS_CPU_CS_MASTER0_COUNT_ADDR A:0x61dd2080
y.create.l HWIO_VENUS0_VENUS_CPU_CS_MASTER0_LAT_COUNT_ADDR A:0x61dd2084
y.create.l HWIO_VENUS0_VENUS_CPU_CS_MASTER0_LAT_MAX_COUNT_ADDR A:0x61dd2088
y.create.l HWIO_VENUS0_VENUS_CPU_CS_SLAVE0_CONFIG_ADDR A:0x61dd208c
y.create.l HWIO_VENUS0_VENUS_CPU_CS_SLAVE0_MASK_ADDR A:0x61dd2090
y.create.l HWIO_VENUS0_VENUS_CPU_CS_SLAVE0_MATCH_ADDR A:0x61dd2094
y.create.l HWIO_VENUS0_VENUS_CPU_CS_SLAVE0_COUNT_ADDR A:0x61dd2098
y.create.l HWIO_VENUS0_VENUS_CPU_CS_SLAVE0_LAT_COUNT_ADDR A:0x61dd209c
y.create.l HWIO_VENUS0_VENUS_CPU_CS_SLAVE0_LAT_MAX_COUNT_ADDR A:0x61dd20a0
y.create.l HWIO_VENUS0_VENUS_CPU_CS_MASTER1_CONFIG_ADDR A:0x61dd20a4
y.create.l HWIO_VENUS0_VENUS_CPU_CS_MASTER1_MASK_ADDR A:0x61dd20a8
y.create.l HWIO_VENUS0_VENUS_CPU_CS_MASTER1_MATCH_ADDR A:0x61dd20ac
y.create.l HWIO_VENUS0_VENUS_CPU_CS_MASTER1_COUNT_ADDR A:0x61dd20b0
y.create.l HWIO_VENUS0_VENUS_CPU_CS_MASTER1_LAT_COUNT_ADDR A:0x61dd20b4
y.create.l HWIO_VENUS0_VENUS_CPU_CS_MASTER1_LAT_MAX_COUNT_ADDR A:0x61dd20b8
y.create.l HWIO_VENUS0_VENUS_CPU_CS_SLAVE1_CONFIG_ADDR A:0x61dd20bc
y.create.l HWIO_VENUS0_VENUS_CPU_CS_SLAVE1_MASK_ADDR A:0x61dd20c0
y.create.l HWIO_VENUS0_VENUS_CPU_CS_SLAVE1_MATCH_ADDR A:0x61dd20c4
y.create.l HWIO_VENUS0_VENUS_CPU_CS_SLAVE1_COUNT_ADDR A:0x61dd20c8
y.create.l HWIO_VENUS0_VENUS_CPU_CS_SLAVE1_LAT_COUNT_ADDR A:0x61dd20cc
y.create.l HWIO_VENUS0_VENUS_CPU_CS_SLAVE1_LAT_MAX_COUNT_ADDR A:0x61dd20d0
y.create.l HWIO_VENUS0_VENUS_CPU_CS_AXI_CONFIG_ADDR A:0x61dd20d4
y.create.l HWIO_VENUS0_VENUS_CPU_CS_AXI_MASK_ADDR A:0x61dd20d8
y.create.l HWIO_VENUS0_VENUS_CPU_CS_AXI_ADDR_MATCH_ADDR A:0x61dd20dc
y.create.l HWIO_VENUS0_VENUS_CPU_CS_AXI_ADDR_CNTRL_MATCH_ADDR A:0x61dd20e0
y.create.l HWIO_VENUS0_VENUS_CPU_CS_AXI_ADDR_MATCH_COUNT_ADDR A:0x61dd20e4
y.create.l HWIO_VENUS0_VENUS_CPU_CS_AXI_WR_ERR_COUNT_ADDR A:0x61dd20e8
y.create.l HWIO_VENUS0_VENUS_CPU_CS_AXI_RD_ERR_COUNT_ADDR A:0x61dd20ec
y.create.l HWIO_VENUS0_VENUS_CPU_CS_AXI_WR_LAT_COUNT_ADDR A:0x61dd20f0
y.create.l HWIO_VENUS0_VENUS_CPU_CS_AXI_RD_LAT_COUNT_ADDR A:0x61dd20f4
y.create.l HWIO_VENUS0_VENUS_CPU_CS_AXI_WR_LAT_MAX_COUNT_ADDR A:0x61dd20f8
y.create.l HWIO_VENUS0_VENUS_CPU_CS_AXI_RD_LAT_MAX_COUNT_ADDR A:0x61dd20fc
y.create.l HWIO_VENUS0_VENUS_CPU_CS_AHBERRINTEN_ADDR A:0x61dd2100
y.create.l HWIO_VENUS0_VENUS_CPU_CS_AHBERRINTENCLR_ADDR A:0x61dd2104
y.create.l HWIO_VENUS0_VENUS_CPU_CS_VBIF_SSID_ADDR A:0x61dd2108
y.create.l HWIO_VENUS0_VENUS_CPU_CS_JTAGTCKEN_ADDR A:0x61dd210c
y.create.l HWIO_VENUS0_VENUS_CPU_CS_CGCEN_ADDR A:0x61dd2110
y.create.l HWIO_VENUS0_VENUS_CPU_IC_ICIRQSTATUS_ADDR A:0x61ddf000
y.create.l HWIO_VENUS0_VENUS_CPU_IC_ICFIQSTATUS_ADDR A:0x61ddf004
y.create.l HWIO_VENUS0_VENUS_CPU_IC_ICRAWINTR_ADDR A:0x61ddf008
y.create.l HWIO_VENUS0_VENUS_CPU_IC_ICINTSELECT_ADDR A:0x61ddf00c
y.create.l HWIO_VENUS0_VENUS_CPU_IC_ICINTENABLE_ADDR A:0x61ddf010
y.create.l HWIO_VENUS0_VENUS_CPU_IC_ICINTENCLEAR_ADDR A:0x61ddf014
y.create.l HWIO_VENUS0_VENUS_CPU_IC_ICSOFTINT_ADDR A:0x61ddf018
y.create.l HWIO_VENUS0_VENUS_CPU_IC_ICSOFTINTCLEAR_ADDR A:0x61ddf01c
y.create.l HWIO_VENUS0_VENUS_CPU_IC_ICPROTECTION_ADDR A:0x61ddf020
y.create.l HWIO_VENUS0_VENUS_CPU_IC_ICVECTADDR_ADDR A:0x61ddf030
y.create.l HWIO_VENUS0_VENUS_CPU_IC_ICDEFVECTADDR_ADDR A:0x61ddf034
y.create.l HWIO_VENUS0_VENUS_CPU_IC_ICITCR_ADDR A:0x61ddf300
y.create.l HWIO_VENUS0_VENUS_CPU_IC_ICITIP1_ADDR A:0x61ddf304
y.create.l HWIO_VENUS0_VENUS_CPU_IC_ICITIP2_ADDR A:0x61ddf308
y.create.l HWIO_VENUS0_VENUS_CPU_IC_ICITOP1_ADDR A:0x61ddf30c
y.create.l HWIO_VENUS0_VENUS_CPU_IC_ICITOP2_ADDR A:0x61ddf310
y.create.l HWIO_VENUS0_VENUS_CPU_IC_ICPERIPHID0_ADDR A:0x61ddffe0
y.create.l HWIO_VENUS0_VENUS_CPU_IC_ICPERIPHID1_ADDR A:0x61ddffe4
y.create.l HWIO_VENUS0_VENUS_CPU_IC_ICPERIPHID2_ADDR A:0x61ddffe8
y.create.l HWIO_VENUS0_VENUS_CPU_IC_ICPERIPHID3_ADDR A:0x61ddffec
y.create.l HWIO_VENUS0_VENUS_CPU_IC_ICPCELLID0_ADDR A:0x61ddfff0
y.create.l HWIO_VENUS0_VENUS_CPU_IC_ICPCELLID1_ADDR A:0x61ddfff4
y.create.l HWIO_VENUS0_VENUS_CPU_IC_ICPCELLID2_ADDR A:0x61ddfff8
y.create.l HWIO_VENUS0_VENUS_CPU_IC_ICPCELLID3_ADDR A:0x61ddfffc
y.create.l HWIO_VENUS0_VENUS_VBIF_VERSION_ADDR A:0x61d80000
y.create.l HWIO_VENUS0_VENUS_VBIF_CLKON_ADDR A:0x61d80004
y.create.l HWIO_VENUS0_VENUS_VBIF_CLK_FORCE_CTRL0_ADDR A:0x61d80008
y.create.l HWIO_VENUS0_VENUS_VBIF_CLK_FORCE_CTRL1_ADDR A:0x61d8000c
y.create.l HWIO_VENUS0_VENUS_VBIF_QOS_OVERRIDE_EN_ADDR A:0x61d80010
y.create.l HWIO_VENUS0_VENUS_VBIF_PRILVL_ACT_PROP_EN_ADDR A:0x61d80014
y.create.l HWIO_VENUS0_VENUS_VBIF_QOS_OVERRIDE_REQPRI_ADDR A:0x61d80018
y.create.l HWIO_VENUS0_VENUS_VBIF_QOS_OVERRIDE_PRILVL_ADDR A:0x61d8001c
y.create.l HWIO_VENUS0_VENUS_VBIF_QOS_REMAP_00_ADDR A:0x61d80020
y.create.l HWIO_VENUS0_VENUS_VBIF_QOS_REMAP_01_ADDR A:0x61d80024
y.create.l HWIO_VENUS0_VENUS_VBIF_QOS_REMAP_10_ADDR A:0x61d80028
y.create.l HWIO_VENUS0_VENUS_VBIF_QOS_REMAP_11_ADDR A:0x61d8002c
y.create.l HWIO_VENUS0_VENUS_VBIF_IN_RD_LIM_CONF0_ADDR A:0x61d800b0
y.create.l HWIO_VENUS0_VENUS_VBIF_IN_WR_LIM_CONF0_ADDR A:0x61d800c0
y.create.l HWIO_VENUS0_VENUS_VBIF_OUT_RD_LIM_CONF0_ADDR A:0x61d800d0
y.create.l HWIO_VENUS0_VENUS_VBIF_OUT_WR_LIM_CONF0_ADDR A:0x61d800d4
y.create.l HWIO_VENUS0_VENUS_VBIF_DDR_OUT_MAX_BURST_ADDR A:0x61d800d8
y.create.l HWIO_VENUS0_VENUS_VBIF_ISO_SYNC_ADDR A:0x61d800e0
y.create.l HWIO_VENUS0_VENUS_VBIF_ARB_CTL_ADDR A:0x61d800f0
y.create.l HWIO_VENUS0_VENUS_VBIF_DDR_ARB_CONF0_ADDR A:0x61d800f4
y.create.l HWIO_VENUS0_VENUS_VBIF_FIXED_ARB_CONF0_ADDR A:0x61d80100
y.create.l HWIO_VENUS0_VENUS_VBIF_ROUND_ROBIN_QOS_ARB_ADDR A:0x61d80124
y.create.l HWIO_VENUS0_VENUS_VBIF_OUT_AXI_AMEMTYPE_CONF0_ADDR A:0x61d80160
y.create.l HWIO_VENUS0_VENUS_VBIF_OUT_AXI_AINST_OVERRIDE_EN_ADDR A:0x61d80168
y.create.l HWIO_VENUS0_VENUS_VBIF_OUT_AXI_AINST_ADDR A:0x61d8016c
y.create.l HWIO_VENUS0_VENUS_VBIF_OUT_AXI_ASHARED_ADDR A:0x61d80170
y.create.l HWIO_VENUS0_VENUS_VBIF_OUT_AXI_AINNERSHARED_ADDR A:0x61d80174
y.create.l HWIO_VENUS0_VENUS_VBIF_OUT_AXI_AOOO_EN_ADDR A:0x61d80178
y.create.l HWIO_VENUS0_VENUS_VBIF_OUT_AXI_AOOO_ADDR A:0x61d8017c
y.create.l HWIO_VENUS0_VENUS_VBIF_OUT_AXI_ANOALLOCATE_ADDR A:0x61d80180
y.create.l HWIO_VENUS0_VENUS_VBIF_WD_TIMEOUT_ADDR A:0x61d80184
y.create.l HWIO_VENUS0_VENUS_VBIF_PND_ERR_ADDR A:0x61d80190
y.create.l HWIO_VENUS0_VENUS_VBIF_SRC_ERR_ADDR A:0x61d80194
y.create.l HWIO_VENUS0_VENUS_VBIF_ERR_MASK_ADDR A:0x61d80198
y.create.l HWIO_VENUS0_VENUS_VBIF_ERR_CLR_ADDR A:0x61d8019c
y.create.l HWIO_VENUS0_VENUS_VBIF_ERR_INFO_ADDR A:0x61d801a0
y.create.l HWIO_VENUS0_VENUS_VBIF_AXI_TEST_CTL_ADDR A:0x61d801b0
y.create.l HWIO_VENUS0_VENUS_VBIF_AXI_TEST_OUT_ADDR A:0x61d801b4
y.create.l HWIO_VENUS0_VENUS_VBIF_XIN_HALT_CTRL0_ADDR A:0x61d80200
y.create.l HWIO_VENUS0_VENUS_VBIF_XIN_HALT_CTRL1_ADDR A:0x61d80204
y.create.l HWIO_VENUS0_VENUS_VBIF_AXI_HALT_CTRL0_ADDR A:0x61d80208
y.create.l HWIO_VENUS0_VENUS_VBIF_AXI_HALT_CTRL1_ADDR A:0x61d8020c
y.create.l HWIO_VENUS0_VENUS_VBIF_TEST_BUS_OUT_CTRL_ADDR A:0x61d80210
y.create.l HWIO_VENUS0_VENUS_VBIF_TEST_BUS1_CTRL0_ADDR A:0x61d80214
y.create.l HWIO_VENUS0_VENUS_VBIF_TEST_BUS1_CTRL1_ADDR A:0x61d80218
y.create.l HWIO_VENUS0_VENUS_VBIF_TEST_BUS2_CTRL0_ADDR A:0x61d8021c
y.create.l HWIO_VENUS0_VENUS_VBIF_TEST_BUS2_CTRL1_ADDR A:0x61d80220
y.create.l HWIO_VENUS0_VENUS_VBIF_TEST_BUS_AHB_CTRL_ADDR A:0x61d8022c
y.create.l HWIO_VENUS0_VENUS_VBIF_TEST_BUS_OUT_ADDR A:0x61d80230
y.create.l HWIO_VENUS0_VENUS_VBIF_ATB_CONF0_ADDR A:0x61d80240
y.create.l HWIO_VENUS0_VENUS_VBIF_ATB_CONF1_ADDR A:0x61d80244
y.create.l HWIO_VENUS0_VENUS_VBIF_ATB_CONF2_ADDR A:0x61d80248
y.create.l HWIO_VENUS0_VENUS_VBIF_ATB_CONF3_ADDR A:0x61d8024c
y.create.l HWIO_VENUS0_VENUS_VBIF_ATB_TEST_VALUE_ADDR A:0x61d80250
y.create.l HWIO_VENUS0_VENUS_VBIF_STM_CONF_ADDR A:0x61d80260
y.create.l HWIO_VENUS0_VENUS_VBIF_WR_BUF_FOR_AP_ADDR A:0x61d80270
y.create.l HWIO_VENUS0_VENUS_VBIF_PERF_CNT_EN0_ADDR A:0x61d80300
y.create.l HWIO_VENUS0_VENUS_VBIF_PERF_CNT_EN1_ADDR A:0x61d80304
y.create.l HWIO_VENUS0_VENUS_VBIF_PERF_CNT_CLR0_ADDR A:0x61d80320
y.create.l HWIO_VENUS0_VENUS_VBIF_PERF_CNT_CLR1_ADDR A:0x61d80324
y.create.l HWIO_VENUS0_VENUS_VBIF_PERF_CNT_SEL0_ADDR A:0x61d80340
y.create.l HWIO_VENUS0_VENUS_VBIF_PERF_CNT_SEL1_ADDR A:0x61d80344
y.create.l HWIO_VENUS0_VENUS_VBIF_PERF_CNT_L0_ADDR A:0x61d80360
y.create.l HWIO_VENUS0_VENUS_VBIF_PERF_CNT_L1_ADDR A:0x61d80364
y.create.l HWIO_VENUS0_VENUS_VBIF_PERF_CNT_H0_ADDR A:0x61d80380
y.create.l HWIO_VENUS0_VENUS_VBIF_PERF_CNT_H1_ADDR A:0x61d80384
y.create.l HWIO_VENUS0_VENUS_VBIF_PERF_PWR_CNT_EN0_ADDR A:0x61d80400
y.create.l HWIO_VENUS0_VENUS_VBIF_PERF_PWR_CNT_EN1_ADDR A:0x61d80404
y.create.l HWIO_VENUS0_VENUS_VBIF_PERF_PWR_CNT_EN2_ADDR A:0x61d80408
y.create.l HWIO_VENUS0_VENUS_VBIF_PERF_PWR_CNT_CLR0_ADDR A:0x61d80420
y.create.l HWIO_VENUS0_VENUS_VBIF_PERF_PWR_CNT_CLR1_ADDR A:0x61d80424
y.create.l HWIO_VENUS0_VENUS_VBIF_PERF_PWR_CNT_CLR2_ADDR A:0x61d80428
y.create.l HWIO_VENUS0_VENUS_VBIF_PERF_PWR_CNT_L0_ADDR A:0x61d80440
y.create.l HWIO_VENUS0_VENUS_VBIF_PERF_PWR_CNT_L1_ADDR A:0x61d80444
y.create.l HWIO_VENUS0_VENUS_VBIF_PERF_PWR_CNT_L2_ADDR A:0x61d80448
y.create.l HWIO_VENUS0_VENUS_VBIF_PERF_PWR_CNT_H0_ADDR A:0x61d80460
y.create.l HWIO_VENUS0_VENUS_VBIF_PERF_PWR_CNT_H1_ADDR A:0x61d80464
y.create.l HWIO_VENUS0_VENUS_VBIF_PERF_PWR_CNT_H2_ADDR A:0x61d80468
y.create.l HWIO_VENUS0_VENUS_VBIF_MISR_CFG_A0_ADDR A:0x61d80480
y.create.l HWIO_VENUS0_VENUS_VBIF_MISR_COUNTER_ADDR A:0x61d80490
y.create.l HWIO_VENUS0_VENUS_VBIF_MISR_CLR_A0_ADDR A:0x61d80494
y.create.l HWIO_VENUS0_VENUS_VBIF_MISR_A0_SIG0_ADDR A:0x61d804a4
y.create.l HWIO_VENUS0_VENUS_VBIF_MISR_A0_SIG1_ADDR A:0x61d804a8
y.create.l HWIO_VENUS0_VENUS_VBIF_MISR_A0_SIG2_ADDR A:0x61d804ac
y.create.l HWIO_VENUS0_VENUS_VBIF_MISR_A0_SIG3_ADDR A:0x61d804b0
y.create.l HWIO_VENUS0_VENUS_VBIF_ADDR_TRANS_EN_ADDR A:0x61d81000
y.create.l HWIO_VENUS0_VENUS_VBIF_AT_OLD_BASE_ADDR A:0x61d81004
y.create.l HWIO_VENUS0_VENUS_VBIF_AT_OLD_HIGH_ADDR A:0x61d81008
y.create.l HWIO_VENUS0_VENUS_VBIF_AT_NEW_BASE_ADDR A:0x61d81010
y.create.l HWIO_VENUS0_VENUS_VBIF_AT_NEW_HIGH_ADDR A:0x61d81018
y.create.l HWIO_VENUS0_VENUS_VBIF_ATB_EN_ADDR A:0x61d81030
y.create.l HWIO_VENUS0_VENUS_VBIF_STM_EN_ADDR A:0x61d81040
y.create.l HWIO_VENUS0_VENUS_VBIF_DDR_OUTPUT_RECOVERABLE_HALT_CTRL0_ADDR A:0x61d82000
y.create.l HWIO_VENUS0_VENUS_VBIF_DDR_OUTPUT_RECOVERABLE_HALT_CTRL1_ADDR A:0x61d82004
y.create.l HWIO_VENUS0_VENUS_WRAPPER_HW_VERSION_ADDR A:0x61de0000
y.create.l HWIO_VENUS0_VENUS_WRAPPER_CLOCK_CONFIG_ADDR A:0x61de0004
y.create.l HWIO_VENUS0_VENUS_WRAPPER_EFUSE_MONITOR_ADDR A:0x61de0008
y.create.l HWIO_VENUS0_VENUS_WRAPPER_INTR_STATUS_ADDR A:0x61de000c
y.create.l HWIO_VENUS0_VENUS_WRAPPER_INTR_MASK_ADDR A:0x61de0010
y.create.l HWIO_VENUS0_VENUS_WRAPPER_INTR_CLEAR_ADDR A:0x61de0014
y.create.l HWIO_VENUS0_VENUS_WRAPPER_VBIF_REQ_PRIORITY_ADDR A:0x61de0020
y.create.l HWIO_VENUS0_VENUS_WRAPPER_VBIF_PRIORITY_LEVEL_ADDR A:0x61de0024
y.create.l HWIO_VENUS0_VENUS_WRAPPER_VBIF_ATID_ADDR A:0x61de0030
y.create.l HWIO_VENUS0_VENUS_WRAPPER_VBIF_ATB_SEL_ADDR A:0x61de0034
y.create.l HWIO_VENUS0_VENUS_WRAPPER_VBIF_MUX_SEL_ADDR A:0x61de0038
y.create.l HWIO_VENUS0_VENUS_WRAPPER_TEST_BUS_SEL_ADDR A:0x61de0040
y.create.l HWIO_VENUS0_VENUS_WRAPPER_MMCC_VENUS0_POWER_STATUS_ADDR A:0x61de0044
y.create.l HWIO_VENUS0_VENUS_WRAPPER_VENUS0_MMCC_VDEC_VCODEC_POWER_CONTROL_ADDR A:0x61de0048
y.create.l HWIO_VENUS0_VENUS_WRAPPER_VENUS0_MMCC_VENC_POWER_CONTROL_ADDR A:0x61de004c
y.create.l HWIO_VENUS0_VENUS_WRAPPER_MODE_OF_OPERATION_ADDR A:0x61de0050
y.create.l HWIO_VENUS0_VENUS_WRAPPER_VDMA_COMMON_CTRL_ADDR A:0x61de0054
y.create.l HWIO_VENUS0_VENUS_WRAPPER_DANGER_LEVEL_DEC_ADDR A:0x61de0058
y.create.l HWIO_VENUS0_VENUS_WRAPPER_DANGER_LEVEL_ENC_ADDR A:0x61de005c
y.create.l HWIO_VENUS0_VENUS_WRAPPER_ERR_STATUS_ADDR A:0x61de0060
y.create.l HWIO_VENUS0_VENUS_WRAPPER_SPARE_ADDR A:0x61de0ffc
y.create.l HWIO_VENUS0_VENUS_WRAPPER_VBIF_SS_SEC_SID_0_SECURE_ADDR A:0x61de1000
y.create.l HWIO_VENUS0_VENUS_WRAPPER_VBIF_SS_SEC_SID_1_SECURE_ADDR A:0x61de1004
y.create.l HWIO_VENUS0_VENUS_WRAPPER_VBIF_SS_SEC_SID_2_SECURE_ADDR A:0x61de1008
y.create.l HWIO_VENUS0_VENUS_WRAPPER_VBIF_SS_SEC_SID_3_SECURE_ADDR A:0x61de100c
y.create.l HWIO_VENUS0_VENUS_WRAPPER_VBIF_SS_SEC_SID_4_SECURE_ADDR A:0x61de1010
y.create.l HWIO_VENUS0_VENUS_WRAPPER_VBIF_SS_SEC_SID_5_SECURE_ADDR A:0x61de1014
y.create.l HWIO_VENUS0_VENUS_WRAPPER_VBIF_SS_SEC_SID_6_SECURE_ADDR A:0x61de1018
y.create.l HWIO_VENUS0_VENUS_WRAPPER_VBIF_SS_SEC_SID_7_SECURE_ADDR A:0x61de101c
y.create.l HWIO_VENUS0_VENUS_WRAPPER_VBIF_SS_SEC_CPA_START_ADDR_ADDR A:0x61de1020
y.create.l HWIO_VENUS0_VENUS_WRAPPER_VBIF_SS_SEC_CPA_END_ADDR_ADDR A:0x61de1024
y.create.l HWIO_VENUS0_VENUS_WRAPPER_VBIF_SS_SEC_FW_START_ADDR_ADDR A:0x61de1028
y.create.l HWIO_VENUS0_VENUS_WRAPPER_VBIF_SS_SEC_FW_END_ADDR_ADDR A:0x61de102c
y.create.l HWIO_VENUS0_VENUS_WRAPPER_VBIF_SS_SEC_NONPIX_START_ADDR_ADDR A:0x61de1030
y.create.l HWIO_VENUS0_VENUS_WRAPPER_VBIF_SS_SEC_NONPIX_END_ADDR_ADDR A:0x61de1034
y.create.l HWIO_VENUS0_VENUS_WRAPPER_VBIF_SS_SEC_SID_8_SECURE_ADDR A:0x61de1040
y.create.l HWIO_VENUS0_VENUS_WRAPPER_VBIF_SS_SEC_SID_9_SECURE_ADDR A:0x61de1044
y.create.l HWIO_VENUS0_VENUS_WRAPPER_VBIF_SS_SEC_SID_A_SECURE_ADDR A:0x61de1048
y.create.l HWIO_VENUS0_VENUS_WRAPPER_VBIF_SS_SEC_SID_B_SECURE_ADDR A:0x61de104c
y.create.l HWIO_VENUS0_VENUS_WRAPPER_VBIF_SS_SEC_SID_C_SECURE_ADDR A:0x61de1050
y.create.l HWIO_VENUS0_VENUS_WRAPPER_VBIF_SS_SEC_SID_D_SECURE_ADDR A:0x61de1054
y.create.l HWIO_VENUS0_VENUS_WRAPPER_VBIF_SS_SEC_SID_E_SECURE_ADDR A:0x61de1058
y.create.l HWIO_VENUS0_VENUS_WRAPPER_SEC_CSR0_ADDR A:0x61de1080
y.create.l HWIO_VENUS0_VENUS_WRAPPER_SEC_CSR1_ADDR A:0x61de1084
y.create.l HWIO_VENUS0_VENUS_WRAPPER_SEC_CSR2_ADDR A:0x61de1088
y.create.l HWIO_VENUS0_VENUS_WRAPPER_SEC_CSR3_ADDR A:0x61de108c
y.create.l HWIO_VENUS0_VENUS_WRAPPER_SEC_CSR4_ADDR A:0x61de1090
y.create.l HWIO_VENUS0_VENUS_WRAPPER_SEC_CSR5_ADDR A:0x61de1094
y.create.l HWIO_VENUS0_VENUS_WRAPPER_SEC_CSR6_ADDR A:0x61de1098
y.create.l HWIO_VENUS0_VENUS_WRAPPER_SEC_CSR7_ADDR A:0x61de109c
y.create.l HWIO_VENUS0_VENUS_WRAPPER_VBIF_SS_CP_OVERRIDE_DEC_RO_ADDR A:0x61de10a0
y.create.l HWIO_VENUS0_VENUS_WRAPPER_VBIF_SS_CP_OVERRIDE_ENC_RO_ADDR A:0x61de10a4
y.create.l HWIO_VENUS0_VENUS_WRAPPER_VBIF_SS_SEC_SID_0_SECURE_OVERRIDE_RO_ADDR A:0x61de10a8
y.create.l HWIO_VENUS0_VENUS_WRAPPER_VBIF_SS_SEC_SID_1_SECURE_OVERRIDE_RO_ADDR A:0x61de10ac
y.create.l HWIO_VENUS0_VENUS_WRAPPER_VBIF_SS_SEC_SID_2_SECURE_OVERRIDE_RO_ADDR A:0x61de10b0
y.create.l HWIO_VENUS0_VENUS_WRAPPER_VBIF_SS_SEC_SID_3_SECURE_OVERRIDE_RO_ADDR A:0x61de10b4
y.create.l HWIO_VENUS0_VENUS_WRAPPER_VBIF_SS_SEC_SID_4_SECURE_OVERRIDE_RO_ADDR A:0x61de10b8
y.create.l HWIO_VENUS0_VENUS_WRAPPER_VBIF_SS_SEC_SID_5_SECURE_OVERRIDE_RO_ADDR A:0x61de10bc
y.create.l HWIO_VENUS0_VENUS_WRAPPER_VBIF_SS_SEC_SID_6_SECURE_OVERRIDE_RO_ADDR A:0x61de10c0
y.create.l HWIO_VENUS0_VENUS_WRAPPER_VBIF_SS_SEC_SID_7_SECURE_OVERRIDE_RO_ADDR A:0x61de10c4
y.create.l HWIO_VENUS0_VENUS_WRAPPER_VBIF_SS_SEC_SID_8_SECURE_OVERRIDE_RO_ADDR A:0x61de10c8
y.create.l HWIO_VENUS0_VENUS_WRAPPER_VBIF_SS_SEC_SID_9_SECURE_OVERRIDE_RO_ADDR A:0x61de10cc
y.create.l HWIO_VENUS0_VENUS_WRAPPER_VBIF_SS_SEC_SID_A_SECURE_OVERRIDE_RO_ADDR A:0x61de10d0
y.create.l HWIO_VENUS0_VENUS_WRAPPER_VBIF_SS_SEC_SID_B_SECURE_OVERRIDE_RO_ADDR A:0x61de10d4
y.create.l HWIO_VENUS0_VENUS_WRAPPER_VBIF_SS_SEC_SID_C_SECURE_OVERRIDE_RO_ADDR A:0x61de10d8
y.create.l HWIO_VENUS0_VENUS_WRAPPER_VBIF_SS_SEC_SID_D_SECURE_OVERRIDE_RO_ADDR A:0x61de10dc
y.create.l HWIO_VENUS0_VENUS_WRAPPER_VBIF_SS_SEC_SID_E_SECURE_OVERRIDE_RO_ADDR A:0x61de10e0
y.create.l HWIO_VENUS0_VENUS_WRAPPER_VBIF_SS_CP_VP8_SECURE_OVERRIDE_DEC_RO_ADDR A:0x61de10e4
y.create.l HWIO_VENUS0_VENUS_WRAPPER_VBIF_SS_CP_VP9_SECURE_OVERRIDE_DEC_RO_ADDR A:0x61de10e8
y.create.l HWIO_VENUS0_VENUS_WRAPPER_VBIF_SS_SEC_DS_THRESHOLD_RO_ADDR A:0x61de10ec
y.create.l HWIO_VENUS0_VENUS_WRAPPER_VBIF_SS_CCE_THREAD0_OPMODE_ADDR A:0x61de10f0
y.create.l HWIO_VENUS0_VENUS_WRAPPER_VBIF_SS_SDE_THREAD_OPMODE_ADDR A:0x61de10f4
y.create.l HWIO_VENUS0_VENUS_WRAPPER_VBIF_SS_VPP_THREAD_OPMODE_ADDR A:0x61de10f8
y.create.l HWIO_VENUS0_VENUS_WRAPPER_SPARE_1_ADDR A:0x61de10fc
y.create.l HWIO_VENUS0_VENUS_WRAPPER_SPARE_2_ADDR A:0x61de1100
y.create.l HWIO_VENUS0_VENUS_WRAPPER_SPARE_3_ADDR A:0x61de1104
y.create.l HWIO_VENUS0_VENUS_WRAPPER_CPU_CLOCK_CONFIG_ADDR A:0x61de2000
y.create.l HWIO_VENUS0_VENUS_WRAPPER_AXI_HALT_ADDR A:0x61de2008
y.create.l HWIO_VENUS0_VENUS_WRAPPER_AXI_HALT_STATUS_ADDR A:0x61de200c
y.create.l HWIO_VENUS0_VENUS_WRAPPER_CPU_CGC_DIS_ADDR A:0x61de2010
y.create.l HWIO_VENUS0_VENUS_WRAPPER_CPU_STATUS_ADDR A:0x61de2014
y.create.l HWIO_VENUS0_VENUS_WRAPPER_SW_RESET_ADDR A:0x61de3000
y.create.l HWIO_VENUS0_VENUS_WRAPPER_VBIF_SS_CP_OVERRIDE_DEC_ADDR A:0x61de3004
y.create.l HWIO_VENUS0_VENUS_WRAPPER_VBIF_SS_CP_OVERRIDE_ENC_ADDR A:0x61de3008
y.create.l HWIO_VENUS0_VENUS_WRAPPER_VBIF_SS_SEC_SID_0_SECURE_OVERRIDE_ADDR A:0x61de3010
y.create.l HWIO_VENUS0_VENUS_WRAPPER_VBIF_SS_SEC_SID_1_SECURE_OVERRIDE_ADDR A:0x61de3014
y.create.l HWIO_VENUS0_VENUS_WRAPPER_VBIF_SS_SEC_SID_2_SECURE_OVERRIDE_ADDR A:0x61de3018
y.create.l HWIO_VENUS0_VENUS_WRAPPER_VBIF_SS_SEC_SID_3_SECURE_OVERRIDE_ADDR A:0x61de301c
y.create.l HWIO_VENUS0_VENUS_WRAPPER_VBIF_SS_SEC_SID_4_SECURE_OVERRIDE_ADDR A:0x61de3020
y.create.l HWIO_VENUS0_VENUS_WRAPPER_VBIF_SS_SEC_SID_5_SECURE_OVERRIDE_ADDR A:0x61de3024
y.create.l HWIO_VENUS0_VENUS_WRAPPER_VBIF_SS_SEC_SID_6_SECURE_OVERRIDE_ADDR A:0x61de3028
y.create.l HWIO_VENUS0_VENUS_WRAPPER_VBIF_SS_SEC_SID_7_SECURE_OVERRIDE_ADDR A:0x61de302c
y.create.l HWIO_VENUS0_VENUS_WRAPPER_VBIF_SS_SEC_SID_8_SECURE_OVERRIDE_ADDR A:0x61de3030
y.create.l HWIO_VENUS0_VENUS_WRAPPER_VBIF_SS_SEC_SID_9_SECURE_OVERRIDE_ADDR A:0x61de3034
y.create.l HWIO_VENUS0_VENUS_WRAPPER_VBIF_SS_SEC_SID_A_SECURE_OVERRIDE_ADDR A:0x61de3038
y.create.l HWIO_VENUS0_VENUS_WRAPPER_VBIF_SS_SEC_SID_B_SECURE_OVERRIDE_ADDR A:0x61de303c
y.create.l HWIO_VENUS0_VENUS_WRAPPER_VBIF_SS_SEC_SID_C_SECURE_OVERRIDE_ADDR A:0x61de3040
y.create.l HWIO_VENUS0_VENUS_WRAPPER_VBIF_SS_SEC_SID_D_SECURE_OVERRIDE_ADDR A:0x61de3044
y.create.l HWIO_VENUS0_VENUS_WRAPPER_VBIF_SS_SEC_SID_E_SECURE_OVERRIDE_ADDR A:0x61de3048
y.create.l HWIO_VENUS0_VENUS_WRAPPER_VBIF_SS_SEC_THRESHOLD_HEVC_ADDR A:0x61de304c
y.create.l HWIO_VENUS0_VENUS_WRAPPER_VBIF_SS_SEC_THRESHOLD_H264_ADDR A:0x61de3050
y.create.l HWIO_VENUS0_VENUS_WRAPPER_VBIF_SS_SEC_THRESHOLD_VC1_AP_ADDR A:0x61de3054
y.create.l HWIO_VENUS0_VENUS_WRAPPER_VBIF_SS_SEC_THRESHOLD_MP2_ADDR A:0x61de3058
y.create.l HWIO_VENUS0_VENUS_WRAPPER_VBIF_SS_SEC_THRESHOLD_MP4_ADDR A:0x61de305c
y.create.l HWIO_VENUS0_VENUS_WRAPPER_VBIF_SS_SEC_THRESHOLD_H263_ADDR A:0x61de3060
y.create.l HWIO_VENUS0_VENUS_WRAPPER_VBIF_SS_SEC_THRESHOLD_VP8_ADDR A:0x61de3064
y.create.l HWIO_VENUS0_VENUS_WRAPPER_VBIF_SS_SEC_THRESHOLD_VP9_ADDR A:0x61de3068
y.create.l HWIO_VENUS0_VENUS_WRAPPER_VBIF_SS_SEC_THRESHOLD_NON_VCL_HEVC_ADDR A:0x61de306c
y.create.l HWIO_VENUS0_VENUS_WRAPPER_VBIF_SS_SEC_THRESHOLD_NON_VCL_H264_ADDR A:0x61de3070
y.create.l HWIO_VENUS0_VENUS_WRAPPER_VBIF_SS_SEC_THRESHOLD_NON_VCL_MP4_ADDR A:0x61de3074
y.create.l HWIO_VENUS0_VENUS_WRAPPER_VBIF_SS_SEC_THRESHOLD_NON_VCL_MP2_ADDR A:0x61de3078
y.create.l HWIO_VENUS0_VENUS_WRAPPER_VBIF_SS_SEC_THRESHOLD_NON_VCL_VC1_AP_ADDR A:0x61de307c
y.create.l HWIO_VENUS0_VENUS_WRAPPER_VBIF_SS_SEC_THRESHOLD_NON_VCL_H263_ADDR A:0x61de3080
y.create.l HWIO_VENUS0_VENUS_WRAPPER_VBIF_SS_SEC_DS_THRESHOLD_ADDR A:0x61de3084
y.create.l HWIO_VENUS0_VENUS_WRAPPER_VBIF_SS_CP_VP8_SECURE_OVERRIDE_DEC_ADDR A:0x61de3088
y.create.l HWIO_VENUS0_VENUS_WRAPPER_VBIF_SS_CP_VP9_SECURE_OVERRIDE_DEC_ADDR A:0x61de308c
y.create.l HWIO_VENUS0_VENUS_WRAPPER_VBIF_SS_CP_VP8_INSERTED_SC_DEC_ADDR A:0x61de3090
y.create.l HWIO_VENUS0_VENUS_WRAPPER_VBIF_SS_CP_VP9_INSERTED_SC_DEC_ADDR A:0x61de3094
y.create.l HWIO_VENUS0_VENUS_XPU_SCR_ADDR A:0x61df0000
y.create.l HWIO_VENUS0_VENUS_XPU_SWDR_ADDR A:0x61df0004
y.create.l HWIO_VENUS0_VENUS_XPU_SEAR0_ADDR A:0x61df0040
y.create.l HWIO_VENUS0_VENUS_XPU_SESR_ADDR A:0x61df0048
y.create.l HWIO_VENUS0_VENUS_XPU_SESRRESTORE_ADDR A:0x61df004c
y.create.l HWIO_VENUS0_VENUS_XPU_SESYNR0_ADDR A:0x61df0050
y.create.l HWIO_VENUS0_VENUS_XPU_SESYNR1_ADDR A:0x61df0054
y.create.l HWIO_VENUS0_VENUS_XPU_SESYNR2_ADDR A:0x61df0058
y.create.l HWIO_VENUS0_VENUS_XPU_MCR_ADDR A:0x61df0100
y.create.l HWIO_VENUS0_VENUS_XPU_MEAR0_ADDR A:0x61df0140
y.create.l HWIO_VENUS0_VENUS_XPU_MESR_ADDR A:0x61df0148
y.create.l HWIO_VENUS0_VENUS_XPU_MESRRESTORE_ADDR A:0x61df014c
y.create.l HWIO_VENUS0_VENUS_XPU_MESYNR0_ADDR A:0x61df0150
y.create.l HWIO_VENUS0_VENUS_XPU_MESYNR1_ADDR A:0x61df0154
y.create.l HWIO_VENUS0_VENUS_XPU_MESYNR2_ADDR A:0x61df0158
y.create.l HWIO_VENUS0_VENUS_XPU_CR_ADDR A:0x61df0080
y.create.l HWIO_VENUS0_VENUS_XPU_RPU_ACR0_ADDR A:0x61df00a0
y.create.l HWIO_VENUS0_VENUS_XPU_EAR0_ADDR A:0x61df00c0
y.create.l HWIO_VENUS0_VENUS_XPU_ESR_ADDR A:0x61df00c8
y.create.l HWIO_VENUS0_VENUS_XPU_ESRRESTORE_ADDR A:0x61df00cc
y.create.l HWIO_VENUS0_VENUS_XPU_ESYNR0_ADDR A:0x61df00d0
y.create.l HWIO_VENUS0_VENUS_XPU_ESYNR1_ADDR A:0x61df00d4
y.create.l HWIO_VENUS0_VENUS_XPU_ESYNR2_ADDR A:0x61df00d8
y.create.l HWIO_VENUS0_VENUS_XPU_IDR0_ADDR A:0x61df0074
y.create.l HWIO_VENUS0_VENUS_XPU_IDR1_ADDR A:0x61df0078
y.create.l HWIO_VENUS0_VENUS_XPU_REV_ADDR A:0x61df007c
y.create.l HWIO_VENUS0_VENUS_XPU_RG0_RACR0_ADDR A:0x61df0200
y.create.l HWIO_VENUS0_VENUS_XPU_RG1_RACR0_ADDR A:0x61df0280
y.create.l HWIO_VENUS0_VENUS_XPU_RG2_RACR0_ADDR A:0x61df0300
y.create.l HWIO_VENUS0_VENUS_XPU_RG0_WACR0_ADDR A:0x61df0220
y.create.l HWIO_VENUS0_VENUS_XPU_RG1_WACR0_ADDR A:0x61df02a0
y.create.l HWIO_VENUS0_VENUS_XPU_RG2_WACR0_ADDR A:0x61df0320
y.create.l HWIO_VENUS0_VENUS_XPU_RG0_SCR_ADDR A:0x61df0250
y.create.l HWIO_VENUS0_VENUS_XPU_RG1_SCR_ADDR A:0x61df02d0
y.create.l HWIO_VENUS0_VENUS_XPU_RG2_SCR_ADDR A:0x61df0350
y.create.l HWIO_VENUS0_VENUS_XPU_RG0_MCR_ADDR A:0x61df0254
y.create.l HWIO_VENUS0_VENUS_XPU_RG1_MCR_ADDR A:0x61df02d4
y.create.l HWIO_VENUS0_VENUS_XPU_RG2_MCR_ADDR A:0x61df0354
y.create.l HWIO_WCSS_A_BT_SYSCLK_CMPR_EN_ADDR A:0x6a440050
y.create.l HWIO_WCSS_A_BT_SYSCLK_CMPR_INTGR_ADDR A:0x6a440054
y.create.l HWIO_WCSS_A_BT_SYSCLK_CMPR_FRACT_ADDR A:0x6a440058
y.create.l HWIO_WCSS_A_BT_SYSCLK_COUNTVAL_ADDR A:0x6a440070
y.create.l HWIO_WCSS_A_BT_SYSCLK_DEBUG_SEL_ADDR A:0x6a4400cc
y.create.l HWIO_WCSS_A_BT_SYSCLK_DEBUG_CONTROL_1_ADDR A:0x6a4400d4
y.create.l HWIO_WCSS_A_BT_SYSCLK_DEBUG_CONTROL_2_ADDR A:0x6a4400d8
y.create.l HWIO_WCSS_A_BT_SYSCLK_CONTROL_ADDR A:0x6a440100
y.create.l HWIO_WCSS_A_BT_SYSCLK_COMPLETE_ADDR A:0x6a440104
y.create.l HWIO_WCSS_A_BT_SYSCLK_CLKN_CAPTURE_CTL_ADDR A:0x6a440120
y.create.l HWIO_WCSS_A_BT_SYSCLK_CLKN_CAPTURE_INTEGER_VAL_ADDR A:0x6a440124
y.create.l HWIO_WCSS_A_BT_SYSCLK_CLKN_CAPTURE_FRACT_VAL_ADDR A:0x6a440128
y.create.l HWIO_WCSS_A_BT_SYSCLK_MASTER_MEM_ADDR_ADDR A:0x6a440130
y.create.l HWIO_WCSS_A_BT_SYSCLK_SLAVE_BT_ADDR_ADDR A:0x6a440134
y.create.l HWIO_WCSS_A_BT_SYSCLK_PVC_SSBI2_INTR_ADDR A:0x6a4400a0
y.create.l HWIO_WCSS_A_BT_INT_0_INTERRUPT_CONTROL_ADDR A:0x6a3ff000
y.create.l HWIO_WCSS_A_BT_INT_0_BTC_INTERRUPT_MASK_ADDR A:0x6a3ff004
y.create.l HWIO_WCSS_A_BT_INT_0_BTC_INTERRUPT_STATUS_AND_ACKNOWLEDGE_ADDR A:0x6a3ff008
y.create.l HWIO_WCSS_A_BT_INT_0_BTC_PRESLOT_FILTER_ADDR A:0x6a3ff00c
y.create.l HWIO_WCSS_A_BT_INT_0_BTC_SLOT_BURST_TIMER_ADDR A:0x6a3ff010
y.create.l HWIO_WCSS_A_BT_BLUETOOTH_CLOCK_N_COMPARATOR_INTERRUPT_CONTROL_STATUS_ADDR A:0x6a3ff014
y.create.l HWIO_WCSS_A_BT_CAPTURED_BT_CLKN_INTEGER_PORTION_ADDR A:0x6a3ff018
y.create.l HWIO_WCSS_A_BT_CAPTURED_BT_CLKN_FRACTIONAL_PORTION_ADDR A:0x6a3ff01c
y.create.l HWIO_WCSS_A_BT_CAPTURED_BT_CLKA_INTEGER_PORTION_ADDR A:0x6a3ff020
y.create.l HWIO_WCSS_A_BT_CAPTURED_BT_CLKA_FRACTIONAL_PORTION_ADDR A:0x6a3ff024
y.create.l HWIO_WCSS_A_BT_BT_CLOCK_CONTROL_ADDR A:0x6a3ff028
y.create.l HWIO_WCSS_A_BT_BT_CLOCK_ALU_COMMAND_ADDR A:0x6a3ff02c
y.create.l HWIO_WCSS_A_BT_BT_CLOCK_ALU_INTEGER_OPERAND_ADDR A:0x6a3ff030
y.create.l HWIO_WCSS_A_BT_BT_CLOCK_ALU_FRACTIONAL_OPERAND_ADDR A:0x6a3ff034
y.create.l HWIO_WCSS_A_BT_BT_CLOCK_ALU_INTEGER_ACCUMULATOR_ADDR A:0x6a3ff038
y.create.l HWIO_WCSS_A_BT_BT_CLOCK_ALU_FRACTIONAL_ACCUMULATOR_ADDR A:0x6a3ff03c
y.create.l HWIO_WCSS_A_BT_LTE_FRAME_SYNC_CAPTURED_BT_CLKN_INTEGER_PORTION_ADDR A:0x6a3ff040
y.create.l HWIO_WCSS_A_BT_LTE_FRAME_SYNC_CAPTURED_BT_CLKN_FRACTIONAL_PORTION_ADDR A:0x6a3ff044
y.create.l HWIO_WCSS_A_BT_ENCRYPTION_CONTROL_ADDR A:0x6a3ff048
y.create.l HWIO_WCSS_A_BT_ENCRYPTION_K_C_KEY_0_LE_SESSION_KEY_0_ADDR A:0x6a3ff04c
y.create.l HWIO_WCSS_A_BT_ENCRYPTION_K_C_KEY_1_LE_SESSION_KEY_1_ADDR A:0x6a3ff050
y.create.l HWIO_WCSS_A_BT_ENCRYPTION_K_C_KEY_2_LE_SESSION_KEY_2_ADDR A:0x6a3ff054
y.create.l HWIO_WCSS_A_BT_ENCRYPTION_K_C_KEY_3_LE_SESSION_KEY_3_ADDR A:0x6a3ff058
y.create.l HWIO_WCSS_A_BT_CAPTURED_UAP_ADDR A:0x6a3ff05c
y.create.l HWIO_WCSS_A_BT_BT_DEVICE_ADDRESS_0_ADDR A:0x6a3ff060
y.create.l HWIO_WCSS_A_BT_BT_DEVICE_ADDRESS_1_ADDR A:0x6a3ff064
y.create.l HWIO_WCSS_A_BT_HOP_CONTROL_ADDR A:0x6a3ff068
y.create.l HWIO_WCSS_A_BT_HOP_N_COUNT_ADDR A:0x6a3ff06c
y.create.l HWIO_WCSS_A_BT_HOP_OFFSET_ADDR A:0x6a3ff070
y.create.l HWIO_WCSS_A_BT_HOP_COEXISTENCE_LOW_CHANNEL_ADDR A:0x6a3ff074
y.create.l HWIO_WCSS_A_BT_HOP_COEXISTENCE_HIGH_CHANNEL_ADDR A:0x6a3ff078
y.create.l HWIO_WCSS_A_BT_HOP_AFH_CHANNEL_MAP_0_ADDR A:0x6a3ff07c
y.create.l HWIO_WCSS_A_BT_HOP_AFH_CHANNEL_MAP_1_ADDR A:0x6a3ff080
y.create.l HWIO_WCSS_A_BT_HOP_AFH_CHANNEL_MAP_2_ADDR A:0x6a3ff084
y.create.l HWIO_WCSS_A_BT_HOP_HALF_SLOT_0_BCA_CHANNEL_ADDR A:0x6a3ff088
y.create.l HWIO_WCSS_A_BT_HOP_HALF_SLOT_1_BCA_CHANNEL_ADDR A:0x6a3ff08c
y.create.l HWIO_WCSS_A_BT_HOP_FREQUENCY_ADDR A:0x6a3ff090
y.create.l HWIO_WCSS_A_BT_LE_CHANNEL_INDEX_ADDR A:0x6a3ff094
y.create.l HWIO_WCSS_A_BT_HOP_FREQUENCY_1_ADDR A:0x6a3ff098
y.create.l HWIO_WCSS_A_BT_LC_COMMAND_HALF_SLOT_0_ADDR A:0x6a3ff0a0
y.create.l HWIO_WCSS_A_BT_LC_COMMAND_HALF_SLOT_1_ADDR A:0x6a3ff0a4
y.create.l HWIO_WCSS_A_BT_LC_ABORT_ISSUE_AND_STATUS_ADDR A:0x6a3ff0a8
y.create.l HWIO_WCSS_A_BT_LLR_TRIGGER_REPETITION_ADDR A:0x6a3ff0ac
y.create.l HWIO_WCSS_A_BT_RX_CONTROL_ADDR A:0x6a3ff0b0
y.create.l HWIO_WCSS_A_BT_RX_NORMAL_APERTURE_WINDOW_ADDR A:0x6a3ff0b4
y.create.l HWIO_WCSS_A_BT_RX_WIDE_APERTURE_WINDOW_ADDR A:0x6a3ff0b8
y.create.l HWIO_WCSS_A_BT_RX_BCA_WINDOW_ADDR A:0x6a3ff0bc
y.create.l HWIO_WCSS_A_BT_SW_WHITEN_SEED_ADDR A:0x6a3ff0c0
y.create.l HWIO_WCSS_A_BT_RX_ACL_HEADER_THRESHOLD_ADDR A:0x6a3ff0c4
y.create.l HWIO_WCSS_A_BT_RX_SCO_HEADER_THRESHOLD_ADDR A:0x6a3ff0c8
y.create.l HWIO_WCSS_A_BT_HOP_OFFSET_1_ADDR A:0x6a3ff0cc
y.create.l HWIO_WCSS_A_BT_RX_SYNC_WORD_0_ADDR A:0x6a3ff0d0
y.create.l HWIO_WCSS_A_BT_RX_SYNC_WORD_1_ADDR A:0x6a3ff0d4
y.create.l HWIO_WCSS_A_BT_RX_SCO_PAYLOAD_LENGTH_ADDR A:0x6a3ff0d8
y.create.l HWIO_WCSS_A_BT_RX_AM_ADDRESS_ARRAY_POINTER_ADDR A:0x6a3ff0dc
y.create.l HWIO_WCSS_A_BT_RX_BUFFER_SCO_POINTER_ADDR A:0x6a3ff0e0
y.create.l HWIO_WCSS_A_BT_RX_BUFFER_ACL_POINTER_ADDR A:0x6a3ff0e4
y.create.l HWIO_WCSS_A_BT_RX_BUFFER_LMP_POINTER_ADDR A:0x6a3ff0e8
y.create.l HWIO_WCSS_A_BT_RX_BUFFER_CONTROL_POINTER_ADDR A:0x6a3ff0ec
y.create.l HWIO_WCSS_A_BT_RX_BUFFER_LE_POINTER_ADDR A:0x6a3ff0f0
y.create.l HWIO_WCSS_A_BT_RX_LOW_POWER_CONTROL_ADDR A:0x6a3ff0f4
y.create.l HWIO_WCSS_A_BT_RX_LPPS_BIST_TIMER_INIT_VALUE_ADDR A:0x6a3ff0f8
y.create.l HWIO_WCSS_A_BT_SYNC_WORD_ADDR A:0x6a3ff0fc
y.create.l HWIO_WCSS_A_BT_RX_COMPOSITE_STATUS_ADDR A:0x6a3ff100
y.create.l HWIO_WCSS_A_BT_RX_DETAILED_BAD_STATUS_ADDR A:0x6a3ff104
y.create.l HWIO_WCSS_A_BT_RX_FEC_AND_DONE_STATUS_ADDR A:0x6a3ff108
y.create.l HWIO_WCSS_A_BT_RX_FRAME_TIMING_ERROR_ADDR A:0x6a3ff10c
y.create.l HWIO_WCSS_A_BT_RX_PACKET_HEADER_ERROR_COUNT_ADDR A:0x6a3ff11c
y.create.l HWIO_WCSS_A_BT_RX_PAYLOAD_2_3_FEC_ERROR_DETECTED_COUNT_ADDR A:0x6a3ff124
y.create.l HWIO_WCSS_A_BT_RX_PAYLOAD_FEC_ERROR_CORRECTED_COUNT_ADDR A:0x6a3ff128
y.create.l HWIO_WCSS_A_BT_RX_ENERGY_DETECT_COUNT_ADDR A:0x6a3ff12c
y.create.l HWIO_WCSS_A_BT_RX_LE_PAYLOAD_HEADER_DATA_ADDR A:0x6a3ff134
y.create.l HWIO_WCSS_A_BT_RX_PACKET_HEADER_DATA_ADDR A:0x6a3ff138
y.create.l HWIO_WCSS_A_BT_RX_PAYLOAD_HEADER_DATA_ADDR A:0x6a3ff13c
y.create.l HWIO_WCSS_A_BT_RX_PACKET_HEADER_HEC_ADDR A:0x6a3ff144
y.create.l HWIO_WCSS_A_BT_RX_PAYLOAD_CRC_ADDR A:0x6a3ff148
y.create.l HWIO_WCSS_A_BT_TX_SCO_PAYLOAD_LENGTH_ADDR A:0x6a3ff14c
y.create.l HWIO_WCSS_A_BT_TX_BUFFER_POINTER_ADDR A:0x6a3ff150
y.create.l HWIO_WCSS_A_BT_TX_STATUS_ADDR A:0x6a3ff158
y.create.l HWIO_WCSS_A_BT_COEXISTENCE_RF_ACTIVE_DELAY_TIMER_ADDR A:0x6a3ff15c
y.create.l HWIO_WCSS_A_BT_SOFTWARE_CAPTURE_CALCULATE_COMMAND_ADDR A:0x6a3ff160
y.create.l HWIO_WCSS_A_BT_COEXISTENCE_COMMAND_ADDR A:0x6a3ff164
y.create.l HWIO_WCSS_A_BT_COEXISTENCE_CONTROL_ADDR A:0x6a3ff168
y.create.l HWIO_WCSS_A_BT_COEXISTENCE_ENABLE_AND_POLARITY_ADDR A:0x6a3ff16c
y.create.l HWIO_WCSS_A_BT_COEXISTENCE_STATUS_ADDR A:0x6a3ff170
y.create.l HWIO_WCSS_A_BT_TEST_MUX_CONTROL_ADDR A:0x6a3ff178
y.create.l HWIO_WCSS_A_BT_TEST_MUX_DEBUG_OUTPUT_ADDR A:0x6a3ff17c
y.create.l HWIO_WCSS_A_BT_HARDWARE_VERIFICATION_CONTROL_1_ADDR A:0x6a3ff184
y.create.l HWIO_WCSS_A_BT_HARDWARE_VERIFICATION_CONTROL_2_ADDR A:0x6a3ff188
y.create.l HWIO_WCSS_A_BT_HARDWARE_VERIFICATION_CONTROL_3_ADDR A:0x6a3ff18c
y.create.l HWIO_WCSS_A_BT_HARDWARE_VERIFICATION_CLEAR_STATE_MACHINES_ADDR A:0x6a3ff190
y.create.l HWIO_WCSS_A_BT_HARDWARE_VERIFICATION_STATUS_1_ADDR A:0x6a3ff194
y.create.l HWIO_WCSS_A_BT_HARDWARE_VERIFICATION_STATUS_2_ADDR A:0x6a3ff198
y.create.l HWIO_WCSS_A_BT_BT_CORE_VERSION_ADDR A:0x6a3ff19c
y.create.l HWIO_WCSS_A_BT_PACKET_CONTROL_ADDR A:0x6a3ff1a0
y.create.l HWIO_WCSS_A_BT_TEST_CONTROL_ADDR A:0x6a3ff1a4
y.create.l HWIO_WCSS_A_BT_LE_CONTROL_2_ADDR A:0x6a3ff1a8
y.create.l HWIO_WCSS_A_BT_BLUETOOTH_CLOCK_N_INTEGER_COMPARE_VALUE_0_ADDR A:0x6a3ff1ac
y.create.l HWIO_WCSS_A_BT_BLUETOOTH_CLOCK_N_FRACTIONAL_COMPARE_VALUE_0_ADDR A:0x6a3ff1b0
y.create.l HWIO_WCSS_A_BT_BLUETOOTH_CLOCK_N_INTEGER_COMPARE_VALUE_1_ADDR A:0x6a3ff1b4
y.create.l HWIO_WCSS_A_BT_BLUETOOTH_CLOCK_N_FRACTIONAL_COMPARE_VALUE_1_ADDR A:0x6a3ff1b8
y.create.l HWIO_WCSS_A_BT_BURST_COEXISTENCE_COMMAND_ADDR A:0x6a3ff1bc
y.create.l HWIO_WCSS_A_BT_BURST_COEXISTENCE_STATUS_ADDR A:0x6a3ff1c0
y.create.l HWIO_WCSS_A_BT_BURST_PRESLOT_ADDR A:0x6a3ff1c4
y.create.l HWIO_WCSS_A_BT_BURST_TX_COMMAND_ADDR A:0x6a3ff1c8
y.create.l HWIO_WCSS_A_BT_BURST_TX_HOP_STROBE_ADDR A:0x6a3ff1cc
y.create.l HWIO_WCSS_A_BT_BURST_TX_ON_ADDR A:0x6a3ff1d0
y.create.l HWIO_WCSS_A_BT_BURST_RX_COMMAND_ADDR A:0x6a3ff1d4
y.create.l HWIO_WCSS_A_BT_BURST_RX_HOP_STROBE_ADDR A:0x6a3ff1d8
y.create.l HWIO_WCSS_A_BT_BURST_RX_ON_ADDR A:0x6a3ff1dc
y.create.l HWIO_WCSS_A_BT_RX_ACCESS_CODE_DETECT_HARD_ALIGN_ADDR A:0x6a3ff1e0
y.create.l HWIO_WCSS_A_BT_RX_PACKET_HEADER_HARD_ALIGN_ADDR A:0x6a3ff1e4
y.create.l HWIO_WCSS_A_BT_TX_GUARD_SYNC_LENGTH_ADDR A:0x6a3ff1e8
y.create.l HWIO_WCSS_A_BT_SOFTWARE_INTERRUPT_LATENCY_ADDR A:0x6a3ff1ec
y.create.l HWIO_WCSS_A_BT_RX_DEMODULATOR_DELAY_ADDR A:0x6a3ff1f0
y.create.l HWIO_WCSS_A_BT_TX_PACKET_HEADER_HARD_ALIGN_ADDR A:0x6a3ff1f4
y.create.l HWIO_WCSS_A_BT_BT_TO_LPASS_AUDIO_ADDR A:0x6a3ff1fc
y.create.l HWIO_WCSS_A_BT_LC_RX_AGC_RSSI_OUT_0_ADDR A:0x6a3ff200
y.create.l HWIO_WCSS_A_BT_LC_RX_AGC_RSSI_OUT_1_ADDR A:0x6a3ff204
y.create.l HWIO_WCSS_A_BT_LC_SIF_CTRL_ADDR A:0x6a3ff208
y.create.l HWIO_WCSS_A_BT_MWS_CTRL_ADDR A:0x6a3ff320
y.create.l HWIO_WCSS_A_BT_INT_0_LE_BTC_SLOT_BURST_TIMER_ADDR A:0x6a3ff348
y.create.l HWIO_WCSS_A_BT_LE_BURST_COEXISTENCE_COMMAND_ADDR A:0x6a3ff34c
y.create.l HWIO_WCSS_A_BT_LE_BURST_COEXISTENCE_STATUS_ADDR A:0x6a3ff350
y.create.l HWIO_WCSS_A_BT_LE_BURST_PRESLOT_ADDR A:0x6a3ff354
y.create.l HWIO_WCSS_A_BT_LE_BURST_TX_COMMAND_ADDR A:0x6a3ff358
y.create.l HWIO_WCSS_A_BT_LE_BURST_TX_HOP_STROBE_ADDR A:0x6a3ff35c
y.create.l HWIO_WCSS_A_BT_LE_BURST_TX_ON_ADDR A:0x6a3ff360
y.create.l HWIO_WCSS_A_BT_LE_BURST_RX_COMMAND_ADDR A:0x6a3ff364
y.create.l HWIO_WCSS_A_BT_LE_BURST_RX_HOP_STROBE_ADDR A:0x6a3ff368
y.create.l HWIO_WCSS_A_BT_LE_BURST_RX_ON_ADDR A:0x6a3ff36c
y.create.l HWIO_WCSS_A_BT_PACKET_REPEAT_NUMBER_ADDR A:0x6a3ff370
y.create.l HWIO_WCSS_A_BT_GOOD_CRC_COUNTER_ADDR A:0x6a3ff374
y.create.l HWIO_WCSS_A_BT_LE_RX_HARD_ALIGN_ADDR A:0x6a3ff378
y.create.l HWIO_WCSS_A_BT_LE_CONTROL_ADDR A:0x6a3ff37c
y.create.l HWIO_WCSS_A_BT_LE_HOP_OFFSET_ADDR A:0x6a3ff380
y.create.l HWIO_WCSS_A_BT_BLUETOOTH_CLOCK_N_INTEGER_COMPARE_VALUE_2_ADDR A:0x6a3ff388
y.create.l HWIO_WCSS_A_BT_BLUETOOTH_CLOCK_N_FRACTIONAL_COMPARE_VALUE_2_ADDR A:0x6a3ff38c
y.create.l HWIO_WCSS_A_BT_CRYPTO_TX_PAYLOAD_BUFFER_POINTER_AND_LENGTH_ADDR A:0x6a3ff390
y.create.l HWIO_WCSS_A_BT_CRYPTO_KEYN_ADDR A:0x6a3ff394
y.create.l HWIO_WCSS_A_BT_CRYPTO_A0_B0_B1_ADDR A:0x6a3ff398
y.create.l HWIO_WCSS_A_BT_ERROR_STATUS_REGISTER_ADDR A:0x6a3ff39c
y.create.l HWIO_WCSS_A_BT_CLOCK_GATING_ADDR A:0x6a3ff3a0
y.create.l HWIO_WCSS_A_BT_GAM_GAS_CONFIG_ADDR A:0x6a3ff3a4
y.create.l HWIO_WCSS_A_BT_ESCO_CRYPTO_A0_B0_B1_ADDR A:0x6a3ff3a8
y.create.l HWIO_WCSS_A_CRYPTO4_CRYPTO_VERSION_ADDR A:0x6a400000
y.create.l HWIO_WCSS_A_CRYPTO4_CRYPTO_DATA_IN_ADDR A:0x6a400008
y.create.l HWIO_WCSS_A_CRYPTO4_CRYPTO_DATA_OUT_ADDR A:0x6a400010
y.create.l HWIO_WCSS_A_CRYPTO4_CRYPTO_STATUS_ADDR A:0x6a400100
y.create.l HWIO_WCSS_A_CRYPTO4_CRYPTO_ENGINES_AVAIL_ADDR A:0x6a400104
y.create.l HWIO_WCSS_A_CRYPTO4_CRYPTO_SEG_SIZE_ADDR A:0x6a400200
y.create.l HWIO_WCSS_A_CRYPTO4_CRYPTO_GOPROC_ADDR A:0x6a400204
y.create.l HWIO_WCSS_A_CRYPTO4_CRYPTO_ENCR_SEG_CFG_ADDR A:0x6a400300
y.create.l HWIO_WCSS_A_CRYPTO4_CRYPTO_ENCR_SEG_SIZE_ADDR A:0x6a400304
y.create.l HWIO_WCSS_A_CRYPTO4_CRYPTO_ENCR_SEG_START_ADDR A:0x6a400308
y.create.l HWIO_WCSS_A_CRYPTO4_CRYPTO_ENCR_KEY0_ADDR A:0x6a400310
y.create.l HWIO_WCSS_A_CRYPTO4_CRYPTO_ENCR_KEY1_ADDR A:0x6a400314
y.create.l HWIO_WCSS_A_CRYPTO4_CRYPTO_ENCR_KEY2_ADDR A:0x6a400318
y.create.l HWIO_WCSS_A_CRYPTO4_CRYPTO_ENCR_KEY3_ADDR A:0x6a40031c
y.create.l HWIO_WCSS_A_CRYPTO4_CRYPTO_ENCR_KEY4_ADDR A:0x6a400320
y.create.l HWIO_WCSS_A_CRYPTO4_CRYPTO_ENCR_KEY5_ADDR A:0x6a400324
y.create.l HWIO_WCSS_A_CRYPTO4_CRYPTO_ENCR_KEY6_ADDR A:0x6a400328
y.create.l HWIO_WCSS_A_CRYPTO4_CRYPTO_ENCR_KEY7_ADDR A:0x6a40032c
y.create.l HWIO_WCSS_A_CRYPTO4_CRYPTO_ENCR_XTS_KEY0_ADDR A:0x6a400330
y.create.l HWIO_WCSS_A_CRYPTO4_CRYPTO_ENCR_XTS_KEY1_ADDR A:0x6a400334
y.create.l HWIO_WCSS_A_CRYPTO4_CRYPTO_ENCR_XTS_KEY2_ADDR A:0x6a400338
y.create.l HWIO_WCSS_A_CRYPTO4_CRYPTO_ENCR_XTS_KEY3_ADDR A:0x6a40033c
y.create.l HWIO_WCSS_A_CRYPTO4_CRYPTO_ENCR_XTS_KEY4_ADDR A:0x6a400340
y.create.l HWIO_WCSS_A_CRYPTO4_CRYPTO_ENCR_XTS_KEY5_ADDR A:0x6a400344
y.create.l HWIO_WCSS_A_CRYPTO4_CRYPTO_ENCR_XTS_KEY6_ADDR A:0x6a400348
y.create.l HWIO_WCSS_A_CRYPTO4_CRYPTO_ENCR_XTS_KEY7_ADDR A:0x6a40034c
y.create.l HWIO_WCSS_A_CRYPTO4_CRYPTO_ENCR_CNTR0_IV0_ADDR A:0x6a400350
y.create.l HWIO_WCSS_A_CRYPTO4_CRYPTO_ENCR_CNTR1_IV1_ADDR A:0x6a400354
y.create.l HWIO_WCSS_A_CRYPTO4_CRYPTO_ENCR_CNTR2_IV2_ADDR A:0x6a400358
y.create.l HWIO_WCSS_A_CRYPTO4_CRYPTO_ENCR_CNTR3_IV3_ADDR A:0x6a40035c
y.create.l HWIO_WCSS_A_CRYPTO4_CRYPTO_ENCR_CNTR_MASK_ADDR A:0x6a400360
y.create.l HWIO_WCSS_A_CRYPTO4_CRYPTO_ENCR_XTS_DU_SIZE_ADDR A:0x6a400364
y.create.l HWIO_WCSS_A_CRYPTO4_CRYPTO_AUTH_SEG_CFG_ADDR A:0x6a400400
y.create.l HWIO_WCSS_A_CRYPTO4_CRYPTO_AUTH_SEG_SIZE_ADDR A:0x6a400404
y.create.l HWIO_WCSS_A_CRYPTO4_CRYPTO_AUTH_SEG_START_ADDR A:0x6a400408
y.create.l HWIO_WCSS_A_CRYPTO4_CRYPTO_AUTH_KEY0_ADDR A:0x6a400410
y.create.l HWIO_WCSS_A_CRYPTO4_CRYPTO_AUTH_KEY1_ADDR A:0x6a400414
y.create.l HWIO_WCSS_A_CRYPTO4_CRYPTO_AUTH_KEY2_ADDR A:0x6a400418
y.create.l HWIO_WCSS_A_CRYPTO4_CRYPTO_AUTH_KEY3_ADDR A:0x6a40041c
y.create.l HWIO_WCSS_A_CRYPTO4_CRYPTO_AUTH_KEY4_ADDR A:0x6a400420
y.create.l HWIO_WCSS_A_CRYPTO4_CRYPTO_AUTH_KEY5_ADDR A:0x6a400424
y.create.l HWIO_WCSS_A_CRYPTO4_CRYPTO_AUTH_KEY6_ADDR A:0x6a400428
y.create.l HWIO_WCSS_A_CRYPTO4_CRYPTO_AUTH_KEY7_ADDR A:0x6a40042c
y.create.l HWIO_WCSS_A_CRYPTO4_CRYPTO_AUTH_KEY8_ADDR A:0x6a400430
y.create.l HWIO_WCSS_A_CRYPTO4_CRYPTO_AUTH_KEY9_ADDR A:0x6a400434
y.create.l HWIO_WCSS_A_CRYPTO4_CRYPTO_AUTH_IV0_ADDR A:0x6a400450
y.create.l HWIO_WCSS_A_CRYPTO4_CRYPTO_AUTH_IV1_ADDR A:0x6a400454
y.create.l HWIO_WCSS_A_CRYPTO4_CRYPTO_AUTH_IV2_ADDR A:0x6a400458
y.create.l HWIO_WCSS_A_CRYPTO4_CRYPTO_AUTH_IV3_ADDR A:0x6a40045c
y.create.l HWIO_WCSS_A_CRYPTO4_CRYPTO_AUTH_IV4_ADDR A:0x6a400460
y.create.l HWIO_WCSS_A_CRYPTO4_CRYPTO_AUTH_IV5_ADDR A:0x6a400464
y.create.l HWIO_WCSS_A_CRYPTO4_CRYPTO_AUTH_IV6_ADDR A:0x6a400468
y.create.l HWIO_WCSS_A_CRYPTO4_CRYPTO_AUTH_IV7_ADDR A:0x6a40046c
y.create.l HWIO_WCSS_A_CRYPTO4_CRYPTO_AUTH_IV8_ADDR A:0x6a400470
y.create.l HWIO_WCSS_A_CRYPTO4_CRYPTO_AUTH_IV9_ADDR A:0x6a400474
y.create.l HWIO_WCSS_A_CRYPTO4_CRYPTO_AUTH_INFO_NONCE0_ADDR A:0x6a400490
y.create.l HWIO_WCSS_A_CRYPTO4_CRYPTO_AUTH_INFO_NONCE1_ADDR A:0x6a400494
y.create.l HWIO_WCSS_A_CRYPTO4_CRYPTO_AUTH_INFO_NONCE2_ADDR A:0x6a400498
y.create.l HWIO_WCSS_A_CRYPTO4_CRYPTO_AUTH_INFO_NONCE3_ADDR A:0x6a40049c
y.create.l HWIO_WCSS_A_CRYPTO4_CRYPTO_AUTH_BYTECNT0_ADDR A:0x6a4004a0
y.create.l HWIO_WCSS_A_CRYPTO4_CRYPTO_AUTH_BYTECNT1_ADDR A:0x6a4004a4
y.create.l HWIO_WCSS_A_CRYPTO4_CRYPTO_AUTH_BYTECNT2_ADDR A:0x6a4004a8
y.create.l HWIO_WCSS_A_CRYPTO4_CRYPTO_AUTH_BYTECNT3_ADDR A:0x6a4004ac
y.create.l HWIO_WCSS_A_CRYPTO4_CRYPTO_AUTH_EXP_MAC0_ADDR A:0x6a4004b0
y.create.l HWIO_WCSS_A_CRYPTO4_CRYPTO_AUTH_EXP_MAC1_ADDR A:0x6a4004b4
y.create.l HWIO_WCSS_A_CRYPTO4_CRYPTO_AUTH_EXP_MAC2_ADDR A:0x6a4004b8
y.create.l HWIO_WCSS_A_CRYPTO4_CRYPTO_AUTH_EXP_MAC3_ADDR A:0x6a4004bc
y.create.l HWIO_WCSS_A_CRYPTO4_CRYPTO_AUTH_EXP_MAC4_ADDR A:0x6a4004c0
y.create.l HWIO_WCSS_A_CRYPTO4_CRYPTO_AUTH_EXP_MAC5_ADDR A:0x6a4004c4
y.create.l HWIO_WCSS_A_CRYPTO4_CRYPTO_AUTH_EXP_MAC6_ADDR A:0x6a4004c8
y.create.l HWIO_WCSS_A_CRYPTO4_CRYPTO_AUTH_EXP_MAC7_ADDR A:0x6a4004cc
y.create.l HWIO_WCSS_A_CRYPTO4_CRYPTO_CONFIG_ADDR A:0x6a400500
y.create.l HWIO_WCSS_A_CRYPTO4_CRYPTO_SACR_ADDR A:0x6a400504
y.create.l HWIO_WCSS_A_CRYPTO4_CRYPTO_DEBUG_ADDR A:0x6a400508
y.create.l HWIO_WCSS_A_CRYPTO4_CRYPTO_DATA_SHADOW0_ADDR A:0x6a408000
y.create.l HWIO_WCSS_A_CRYPTO4_CRYPTO_DATA_SHADOW8191_ADDR A:0x6a40fffc
y.create.l HWIO_WCSS_A_QTA_BT_INTR_ADDR A:0x6a4c0000
y.create.l HWIO_WCSS_A_QTA_BT_INTR_EN_ADDR A:0x6a4c0004
y.create.l HWIO_WCSS_A_QTA_BT_UART_CTRL_ADDR A:0x6a4c0008
y.create.l HWIO_WCSS_A_QTA_BT_HW_CTRL_ADDR A:0x6a4c000c
y.create.l HWIO_WCSS_A_QTA_BT_HW_TX_BUFFER_MODIFY_ADDR A:0x6a4c0010
y.create.l HWIO_WCSS_A_QTA_BT_SW_CTRL_ADDR A:0x6a4c0014
y.create.l HWIO_WCSS_A_QTA_BT_SW_TX_FIFO_IN_ADDR A:0x6a4c0018
y.create.l HWIO_WCSS_A_QTA_BT_SW_RX_FIFO_OUT_ADDR A:0x6a4c001c
y.create.l HWIO_WCSS_A_QTA_BT_TESTBUS_ADDR A:0x6a4c0020
y.create.l HWIO_WCSS_A_BT_SSBI2_CFG_SSBI2_PVC_FIFO_ADDR A:0x6a4afffc
y.create.l HWIO_WCSS_A_SSBI2_CFG_SSBI2_CTL_ADDR A:0x6a4a0000
y.create.l HWIO_WCSS_A_SSBI2_CFG_SSBI2_INT_ENABLE_ADDR A:0x6a4a0004
y.create.l HWIO_WCSS_A_SSBI2_CFG_SSBI2_PRIORITIES_ADDR A:0x6a4a0008
y.create.l HWIO_WCSS_A_SSBI2_CFG_SSBI2_BANKS_2_3_CTL_ADDR A:0x6a4a000c
y.create.l HWIO_WCSS_A_SSBI2_CFG_SSBI2_ILLEGAL_STATUS_ADDR A:0x6a4a0010
y.create.l HWIO_WCSS_A_SSBI2_CFG_SSBI2_TEST_BUS_CTL_ADDR A:0x6a4a0014
y.create.l HWIO_WCSS_A_SSBI2_CFG_SSBI2_VIT0_ADDR A:0x6a4a0020
y.create.l HWIO_WCSS_A_SSBI2_CFG_SSBI2_VIT1_ADDR A:0x6a4a0024
y.create.l HWIO_WCSS_A_SSBI2_CFG_SSBI2_VIT2_ADDR A:0x6a4a0028
y.create.l HWIO_WCSS_A_SSBI2_CFG_SSBI2_VIT3_ADDR A:0x6a4a002c
y.create.l HWIO_WCSS_A_SSBI2_CFG_SSBI2_VIT4_ADDR A:0x6a4a0030
y.create.l HWIO_WCSS_A_SSBI2_CFG_SSBI2_VIT5_ADDR A:0x6a4a0034
y.create.l HWIO_WCSS_A_SSBI2_CFG_SSBI2_VIT6_ADDR A:0x6a4a0038
y.create.l HWIO_WCSS_A_SSBI2_CFG_SSBI2_PVC_CTL_ADDR A:0x6a4a00a0
y.create.l HWIO_WCSS_A_SSBI2_CFG_SSBI2_PVC_TABLE0_ADDR A:0x6a4a00a4
y.create.l HWIO_WCSS_A_SSBI2_CFG_SSBI2_PVC_TABLE1_ADDR A:0x6a4a00a8
y.create.l HWIO_WCSS_A_SSBI2_CFG_SSBI2_PVC_TABLE2_ADDR A:0x6a4a00ac
y.create.l HWIO_WCSS_A_SSBI2_CFG_SSBI2_PVC_TABLE3_ADDR A:0x6a4a00b0
y.create.l HWIO_WCSS_A_SSBI2_CFG_SSBI2_PVC_TABLE4_ADDR A:0x6a4a00b4
y.create.l HWIO_WCSS_A_SSBI2_CFG_SSBI2_PVC_TABLE5_ADDR A:0x6a4a00b8
y.create.l HWIO_WCSS_A_SSBI2_CFG_SSBI2_PVC_TABLE6_ADDR A:0x6a4a00bc
y.create.l HWIO_WCSS_A_SSBI2_CFG_SSBI2_PVC_TABLE7_ADDR A:0x6a4a00c0
y.create.l HWIO_WCSS_A_SSBI2_CFG_SSBI2_PVC_TABLE8_ADDR A:0x6a4a00c4
y.create.l HWIO_WCSS_A_SSBI2_CFG_SSBI2_PVC_TABLE9_ADDR A:0x6a4a00c8
y.create.l HWIO_WCSS_A_SSBI2_CMD_SSBI2_CMD_ADDR A:0x6a480000
y.create.l HWIO_WCSS_A_SSBI2_CMD_SSBI2_RD_STATUS_ADDR A:0x6a480004
y.create.l HWIO_WCSS_A_XPU_XPU_SCR_ADDR A:0x6a21f000
y.create.l HWIO_WCSS_A_XPU_XPU_SWDR_ADDR A:0x6a21f004
y.create.l HWIO_WCSS_A_XPU_XPU_SEAR0_ADDR A:0x6a21f040
y.create.l HWIO_WCSS_A_XPU_XPU_SESR_ADDR A:0x6a21f048
y.create.l HWIO_WCSS_A_XPU_XPU_SESRRESTORE_ADDR A:0x6a21f04c
y.create.l HWIO_WCSS_A_XPU_XPU_SESYNR0_ADDR A:0x6a21f050
y.create.l HWIO_WCSS_A_XPU_XPU_SESYNR1_ADDR A:0x6a21f054
y.create.l HWIO_WCSS_A_XPU_XPU_SESYNR2_ADDR A:0x6a21f058
y.create.l HWIO_WCSS_A_XPU_XPU_MCR_ADDR A:0x6a21f100
y.create.l HWIO_WCSS_A_XPU_XPU_MEAR0_ADDR A:0x6a21f140
y.create.l HWIO_WCSS_A_XPU_XPU_MESR_ADDR A:0x6a21f148
y.create.l HWIO_WCSS_A_XPU_XPU_MESRRESTORE_ADDR A:0x6a21f14c
y.create.l HWIO_WCSS_A_XPU_XPU_MESYNR0_ADDR A:0x6a21f150
y.create.l HWIO_WCSS_A_XPU_XPU_MESYNR1_ADDR A:0x6a21f154
y.create.l HWIO_WCSS_A_XPU_XPU_MESYNR2_ADDR A:0x6a21f158
y.create.l HWIO_WCSS_A_XPU_XPU_CR_ADDR A:0x6a21f080
y.create.l HWIO_WCSS_A_XPU_XPU_RPU_ACR0_ADDR A:0x6a21f0a0
y.create.l HWIO_WCSS_A_XPU_XPU_EAR0_ADDR A:0x6a21f0c0
y.create.l HWIO_WCSS_A_XPU_XPU_ESR_ADDR A:0x6a21f0c8
y.create.l HWIO_WCSS_A_XPU_XPU_ESRRESTORE_ADDR A:0x6a21f0cc
y.create.l HWIO_WCSS_A_XPU_XPU_ESYNR0_ADDR A:0x6a21f0d0
y.create.l HWIO_WCSS_A_XPU_XPU_ESYNR1_ADDR A:0x6a21f0d4
y.create.l HWIO_WCSS_A_XPU_XPU_ESYNR2_ADDR A:0x6a21f0d8
y.create.l HWIO_WCSS_A_XPU_XPU_IDR0_ADDR A:0x6a21f074
y.create.l HWIO_WCSS_A_XPU_XPU_IDR1_ADDR A:0x6a21f078
y.create.l HWIO_WCSS_A_XPU_XPU_REV_ADDR A:0x6a21f07c
y.create.l HWIO_WCSS_A_XPU_XPU_RG0_RACR0_ADDR A:0x6a21f200
y.create.l HWIO_WCSS_A_XPU_XPU_RG1_RACR0_ADDR A:0x6a21f280
y.create.l HWIO_WCSS_A_XPU_XPU_RG0_WACR0_ADDR A:0x6a21f220
y.create.l HWIO_WCSS_A_XPU_XPU_RG1_WACR0_ADDR A:0x6a21f2a0
y.create.l HWIO_WCSS_A_XPU_XPU_RG0_SCR_ADDR A:0x6a21f250
y.create.l HWIO_WCSS_A_XPU_XPU_RG1_SCR_ADDR A:0x6a21f2d0
y.create.l HWIO_WCSS_A_XPU_XPU_RG0_MCR_ADDR A:0x6a21f254
y.create.l HWIO_WCSS_A_XPU_XPU_RG1_MCR_ADDR A:0x6a21f2d4
y.create.l HWIO_WCSS_A_PMU_TOP_BCR_ADDR A:0x6a21b000
y.create.l HWIO_WCSS_A_PMU_TOP_AHB_CBCR_ADDR A:0x6a21b008
y.create.l HWIO_WCSS_A_PMU_BUS_TIMEOUT_CBCR_ADDR A:0x6a21b00c
y.create.l HWIO_WCSS_A_PMU_TOP_SLP_CBCR_ADDR A:0x6a21b010
y.create.l HWIO_WCSS_A_PMU_TOP_XO_CBCR_ADDR A:0x6a21b014
y.create.l HWIO_WCSS_A_PMU_AXI_M_CBCR_ADDR A:0x6a21b018
y.create.l HWIO_WCSS_A_PMU_COMMON_SS_BCR_ADDR A:0x6a21b020
y.create.l HWIO_WCSS_A_PMU_COMMON_GDSCR_ADDR A:0x6a21b024
y.create.l HWIO_WCSS_A_PMU_COMMON_PHY_DBG_CBCR_ADDR A:0x6a21b028
y.create.l HWIO_WCSS_A_PMU_COMMON_TRC_CBCR_ADDR A:0x6a21b02c
y.create.l HWIO_WCSS_A_PMU_COMMON_CPU_CBCR_ADDR A:0x6a21b030
y.create.l HWIO_WCSS_A_PMU_COMMON_AHB_CBCR_ADDR A:0x6a21b034
y.create.l HWIO_WCSS_A_PMU_COMMON_BT_32M_CBCR_ADDR A:0x6a21b038
y.create.l HWIO_WCSS_A_PMU_COMMON_BT_FM_19M_CBCR_ADDR A:0x6a21b03c
y.create.l HWIO_WCSS_A_PMU_COMMON_SLP_CBCR_ADDR A:0x6a21b040
y.create.l HWIO_WCSS_A_PMU_COMMON_XO_CBCR_ADDR A:0x6a21b044
y.create.l HWIO_WCSS_A_PMU_WLAN_BCR_ADDR A:0x6a21b050
y.create.l HWIO_WCSS_A_PMU_WLAN_GDSCR_ADDR A:0x6a21b054
y.create.l HWIO_WCSS_A_PMU_WLAN_RFA_CAL_CBCR_ADDR A:0x6a21b058
y.create.l HWIO_WCSS_A_PMU_WLAN_PHY_MAIN1_FAST_CBCR_ADDR A:0x6a21b05c
y.create.l HWIO_WCSS_A_PMU_WLAN_PHY_MAIN1_TX_CBCR_ADDR A:0x6a21b060
y.create.l HWIO_WCSS_A_PMU_WLAN_PHY_MAIN1_RX_CBCR_ADDR A:0x6a21b064
y.create.l HWIO_WCSS_A_PMU_WLAN_PHY_MAIN2_CBCR_ADDR A:0x6a21b068
y.create.l HWIO_WCSS_A_PMU_WLAN_PHY_DBG_CBCR_ADDR A:0x6a21b06c
y.create.l HWIO_WCSS_A_PMU_WLAN_PHY_DAC_CBCR_ADDR A:0x6a21b070
y.create.l HWIO_WCSS_A_PMU_WLAN_AHB_CBCR_ADDR A:0x6a21b074
y.create.l HWIO_WCSS_A_PMU_WLAN_PHY_ADC_CBCR_ADDR A:0x6a21b078
y.create.l HWIO_WCSS_A_PMU_WLAN_RFIF_CBCR_ADDR A:0x6a21b07c
y.create.l HWIO_WCSS_A_PMU_ADC_240M_CBCR_ADDR A:0x6a21b080
y.create.l HWIO_WCSS_A_PMU_DAC_SM_CBCR_ADDR A:0x6a21b084
y.create.l HWIO_WCSS_A_PMU_PHY_FAST_CMD_RCGR_ADDR A:0x6a21b0a0
y.create.l HWIO_WCSS_A_PMU_PHY_FAST_CFG_RCGR_ADDR A:0x6a21b0a4
y.create.l HWIO_WCSS_A_PMU_PHY_CMD_RCGR_ADDR A:0x6a21b0c0
y.create.l HWIO_WCSS_A_PMU_PHY_CFG_RCGR_ADDR A:0x6a21b0c4
y.create.l HWIO_WCSS_A_PMU_PHY_M_ADDR A:0x6a21b0c8
y.create.l HWIO_WCSS_A_PMU_PHY_N_ADDR A:0x6a21b0cc
y.create.l HWIO_WCSS_A_PMU_PHY_D_ADDR A:0x6a21b0d0
y.create.l HWIO_WCSS_A_PMU_ADCDAC_CMD_RCGR_ADDR A:0x6a21b0e0
y.create.l HWIO_WCSS_A_PMU_ADCDAC_CFG_RCGR_ADDR A:0x6a21b0e4
y.create.l HWIO_WCSS_A_PMU_ADCDAC_M_ADDR A:0x6a21b0e8
y.create.l HWIO_WCSS_A_PMU_ADCDAC_N_ADDR A:0x6a21b0ec
y.create.l HWIO_WCSS_A_PMU_ADCDAC_D_ADDR A:0x6a21b0f0
y.create.l HWIO_WCSS_A_PMU_RFIF_CMD_RCGR_ADDR A:0x6a21b100
y.create.l HWIO_WCSS_A_PMU_RFIF_CFG_RCGR_ADDR A:0x6a21b104
y.create.l HWIO_WCSS_A_PMU_RFIF_M_ADDR A:0x6a21b108
y.create.l HWIO_WCSS_A_PMU_RFIF_N_ADDR A:0x6a21b10c
y.create.l HWIO_WCSS_A_PMU_RFIF_D_ADDR A:0x6a21b110
y.create.l HWIO_WCSS_A_PMU_CPU_AHB_CMD_RCGR_ADDR A:0x6a21b120
y.create.l HWIO_WCSS_A_PMU_CPU_AHB_CFG_RCGR_ADDR A:0x6a21b124
y.create.l HWIO_WCSS_A_PMU_CPU_AHB_MISC_ADDR A:0x6a21b134
y.create.l HWIO_WCSS_A_PMU_BT_32M_CMD_RCGR_ADDR A:0x6a21b140
y.create.l HWIO_WCSS_A_PMU_BT_32M_CFG_RCGR_ADDR A:0x6a21b144
y.create.l HWIO_WCSS_A_PMU_BT_FM_19M_CMD_RCGR_ADDR A:0x6a21b160
y.create.l HWIO_WCSS_A_PMU_BT_FM_19M_CFG_RCGR_ADDR A:0x6a21b164
y.create.l HWIO_WCSS_A_PMU_SLP_CMD_RCGR_ADDR A:0x6a21b180
y.create.l HWIO_WCSS_A_PMU_SLP_CFG_RCGR_ADDR A:0x6a21b184
y.create.l HWIO_WCSS_A_PMU_XO_CMD_RCGR_ADDR A:0x6a21b1a0
y.create.l HWIO_WCSS_A_PMU_XO_CFG_RCGR_ADDR A:0x6a21b1a4
y.create.l HWIO_WCSS_A_PMU_PLL_MODE_ADDR A:0x6a21b1c0
y.create.l HWIO_WCSS_A_PMU_PLL_L_VAL_ADDR A:0x6a21b1c4
y.create.l HWIO_WCSS_A_PMU_PLL_M_VAL_ADDR A:0x6a21b1c8
y.create.l HWIO_WCSS_A_PMU_PLL_N_VAL_ADDR A:0x6a21b1cc
y.create.l HWIO_WCSS_A_PMU_PLL_USER_CTL_ADDR A:0x6a21b1d0
y.create.l HWIO_WCSS_A_PMU_PLL_CONFIG_CTL_ADDR A:0x6a21b1d4
y.create.l HWIO_WCSS_A_PMU_PLL_TEST_CTL_ADDR A:0x6a21b1d8
y.create.l HWIO_WCSS_A_PMU_PLL_STATUS_ADDR A:0x6a21b1dc
y.create.l HWIO_WCSS_A_PMU_WCSS_DEBUG_CLK_CTL_ADDR A:0x6a21b1e0
y.create.l HWIO_WCSS_A_PMU_HW_VERSION_ADDR A:0x6a21c000
y.create.l HWIO_WCSS_A_PMU_CFG_ADDR A:0x6a21c004
y.create.l HWIO_WCSS_A_PMU_OVRD_EN_ADDR A:0x6a21c008
y.create.l HWIO_WCSS_A_PMU_OVRD_VAL_ADDR A:0x6a21c00c
y.create.l HWIO_WCSS_A_PMU_SLP_TMR_CTL_ADDR A:0x6a21c010
y.create.l HWIO_WCSS_A_PMU_SLP_TMR_STS_ADDR A:0x6a21c014
y.create.l HWIO_WCSS_A_PMU_SLP_TMR_VAL_WR_ADDR A:0x6a21c018
y.create.l HWIO_WCSS_A_PMU_SLP_TMR_VAL_ADDR A:0x6a21c01c
y.create.l HWIO_WCSS_A_PMU_WLAN_SLP_TMR_CTL_ADDR A:0x6a21c020
y.create.l HWIO_WCSS_A_PMU_WLAN_SLP_TMR_STS_ADDR A:0x6a21c024
y.create.l HWIO_WCSS_A_PMU_WLAN_SLP_TMR_EXP_ADDR A:0x6a21c028
y.create.l HWIO_WCSS_A_PMU_BT_SLP_TMR_CTL_ADDR A:0x6a21c02c
y.create.l HWIO_WCSS_A_PMU_BT_SLP_TMR_STS_ADDR A:0x6a21c030
y.create.l HWIO_WCSS_A_PMU_BT_SLP_TMR_EXP_ADDR A:0x6a21c034
y.create.l HWIO_WCSS_A_PMU_PWR_CNTL_ADCDAC_ADDR A:0x6a21c038
y.create.l HWIO_WCSS_A_PMU_WMAC_CSR_ADDR A:0x6a21c03c
y.create.l HWIO_WCSS_A_PMU_COMMON_CSR_ADDR A:0x6a21c040
y.create.l HWIO_WCSS_A_PMU_ROOT_CLK_ENABLE_ADDR A:0x6a21c044
y.create.l HWIO_WCSS_A_PMU_CLKGATE_DISABLE_ADDR A:0x6a21c048
y.create.l HWIO_WCSS_A_PMU_SOFT_RESET_ADDR A:0x6a21c04c
y.create.l HWIO_WCSS_A_PMU_PMU_TESTBUS_CTL_ADDR A:0x6a21c050
y.create.l HWIO_WCSS_A_PMU_PMU_TESTBUS_STS_ADDR A:0x6a21c054
y.create.l HWIO_WCSS_A_PMU_TESTBUS_CTL_ADDR A:0x6a21c058
y.create.l HWIO_WCSS_A_PMU_TESTBUS_STS_ADDR A:0x6a21c05c
y.create.l HWIO_WCSS_A_PMU_WLAN_POWER_MEASURE_ADDR A:0x6a21c060
y.create.l HWIO_WCSS_A_PMU_WCSS_IPC_ADDR A:0x6a21c064
y.create.l HWIO_WCSS_A_PMU_WDOG_CTL_ADDR A:0x6a21c068
y.create.l HWIO_WCSS_A_PMU_WDOG_STS_ADDR A:0x6a21c06c
y.create.l HWIO_WCSS_A_PMU_WDOG_COUNT_ADDR A:0x6a21c070
y.create.l HWIO_WCSS_A_PMU_WDOG_BITE_SECURE_ADDR A:0x6a21c074
y.create.l HWIO_WCSS_A_PMU_WDOG_BARK_TIME_ADDR A:0x6a21c078
y.create.l HWIO_WCSS_A_PMU_WDOG_BITE_TIME_ADDR A:0x6a21c07c
y.create.l HWIO_WCSS_A_PMU_WDOG_TEST_ADDR A:0x6a21c080
y.create.l HWIO_WCSS_A_PMU_SPARE_IN_ADDR A:0x6a21c084
y.create.l HWIO_WCSS_A_PMU_SPARE_OUT_ADDR A:0x6a21c088
y.create.l HWIO_WCSS_A_PMU_AOA2AB_CTL_ADDR A:0x6a21c08c
y.create.l HWIO_WCSS_A_PMU_AOA2AB_WRAP_ADDR_ADDR A:0x6a21c090
y.create.l HWIO_WCSS_A_PMU_AOA2AB_AHB_ERR_ADDR_ADDR A:0x6a21c094
y.create.l HWIO_WCSS_A_PMU_SPM_DBG_ADDR A:0x6a21c098
y.create.l HWIO_WCSS_A_PMU_DAC_CAL_CTL_ADDR A:0x6a21c09c
y.create.l HWIO_WCSS_A_PMU_BT_SW_EVENT_ADDR A:0x6a21c0a0
y.create.l HWIO_WCSS_A_PMU_IRIS_XO_SETTLE_TIME_ADDR A:0x6a21c124
y.create.l HWIO_WCSS_A_PMU_IRIS_XO_SETTLE_TIMER_CSR_ADDR A:0x6a21c128
y.create.l HWIO_WCSS_A_PMU_IRIS_XO_TIMER_ADDR A:0x6a21c12c
y.create.l HWIO_WCSS_A_PMU_COMMON_SS_MEM_SLP_CTL_ADDR A:0x6a21c130
y.create.l HWIO_WCSS_A_PMU_IRIS_REG_READ_ADDR A:0x6a21c134
y.create.l HWIO_WCSS_A_PMU_WLAN_COEX_CTL_ADDR A:0x6a21c138
y.create.l HWIO_WCSS_A_PMU_CCPU_CTL_ADDR A:0x6a21d000
y.create.l HWIO_WCSS_A_PMU_CCPU_BOOT_REMAP_ADDR_ADDR A:0x6a21d004
y.create.l HWIO_WCSS_A_PMU_CMEM_ACCESS_CTL_ADDR A:0x6a21d008
y.create.l HWIO_WCSS_A_AOAHB_AOAHB_AOWBR_PL_ADDR A:0x6a21a000
y.create.l HWIO_WCSS_A_AOAHB_AOAHB_AOA2AB_PL_ADDR A:0x6a21a004
y.create.l HWIO_WCSS_A_AOAHB_AOAHB_DFLT_MST_ADDR A:0x6a21a048
y.create.l HWIO_WCSS_A_AOAHB_AOAHB_VERSION_ADDR A:0x6a21a090
y.create.l HWIO_WCSS_A_SAW2_SAW2_SECURE_ADDR A:0x6a219000
y.create.l HWIO_WCSS_A_SAW2_SAW2_ID_ADDR A:0x6a219004
y.create.l HWIO_WCSS_A_SAW2_SAW2_CFG_ADDR A:0x6a219008
y.create.l HWIO_WCSS_A_SAW2_SAW2_SPM_STS_ADDR A:0x6a21900c
y.create.l HWIO_WCSS_A_SAW2_SAW2_AVS_STS_ADDR A:0x6a219010
y.create.l HWIO_WCSS_A_SAW2_SAW2_PMIC_STS_ADDR A:0x6a219014
y.create.l HWIO_WCSS_A_SAW2_SAW2_RST_ADDR A:0x6a219018
y.create.l HWIO_WCSS_A_SAW2_SAW2_SPM_CTL_ADDR A:0x6a219030
y.create.l HWIO_WCSS_A_SAW2_SAW2_SPM_DLY_ADDR A:0x6a219034
y.create.l HWIO_WCSS_A_SAW2_SAW2_SPM_STS2_ADDR A:0x6a219038
y.create.l HWIO_WCSS_A_SAW2_SAW2_SPM_SLP_SEQ_ENTRY_0_ADDR A:0x6a219400
y.create.l HWIO_WCSS_A_SAW2_SAW2_SPM_SLP_SEQ_ENTRY_1_ADDR A:0x6a219404
y.create.l HWIO_WCSS_A_SAW2_SAW2_SPM_SLP_SEQ_ENTRY_2_ADDR A:0x6a219408
y.create.l HWIO_WCSS_A_SAW2_SAW2_SPM_SLP_SEQ_ENTRY_3_ADDR A:0x6a21940c
y.create.l HWIO_WCSS_A_SAW2_SAW2_SPM_SLP_SEQ_ENTRY_4_ADDR A:0x6a219410
y.create.l HWIO_WCSS_A_SAW2_SAW2_SPM_SLP_SEQ_ENTRY_5_ADDR A:0x6a219414
y.create.l HWIO_WCSS_A_SAW2_SAW2_SPM_SLP_SEQ_ENTRY_6_ADDR A:0x6a219418
y.create.l HWIO_WCSS_A_SAW2_SAW2_SPM_SLP_SEQ_ENTRY_7_ADDR A:0x6a21941c
y.create.l HWIO_WCSS_A_SAW2_SAW2_SPM_SLP_SEQ_ENTRY_8_ADDR A:0x6a219420
y.create.l HWIO_WCSS_A_SAW2_SAW2_SPM_SLP_SEQ_ENTRY_9_ADDR A:0x6a219424
y.create.l HWIO_WCSS_A_SAW2_SAW2_VERSION_ADDR A:0x6a219fd0
y.create.l HWIO_WCSS_A_QTMR_AC_QTMR_AC_CNTFRQ_ADDR A:0x6a211000
y.create.l HWIO_WCSS_A_QTMR_AC_QTMR_AC_CNTSR_ADDR A:0x6a211004
y.create.l HWIO_WCSS_A_QTMR_AC_QTMR_AC_CNTTID_ADDR A:0x6a211008
y.create.l HWIO_WCSS_A_QTMR_AC_QTMR_AC_CNTACR_0_ADDR A:0x6a211040
y.create.l HWIO_WCSS_A_QTMR_AC_QTMR_AC_CNTACR_1_ADDR A:0x6a211044
y.create.l HWIO_WCSS_A_QTMR_AC_QTMR_AC_CNTACR_2_ADDR A:0x6a211048
y.create.l HWIO_WCSS_A_QTMR_AC_QTMR_AC_CNTACR_3_ADDR A:0x6a21104c
y.create.l HWIO_WCSS_A_QTMR_AC_QTMR_AC_CNTACR_4_ADDR A:0x6a211050
y.create.l HWIO_WCSS_A_QTMR_AC_QTMR_AC_CNTVOFF_LO_0_ADDR A:0x6a211080
y.create.l HWIO_WCSS_A_QTMR_AC_QTMR_AC_CNTVOFF_LO_1_ADDR A:0x6a211088
y.create.l HWIO_WCSS_A_QTMR_AC_QTMR_AC_CNTVOFF_LO_2_ADDR A:0x6a211090
y.create.l HWIO_WCSS_A_QTMR_AC_QTMR_AC_CNTVOFF_LO_3_ADDR A:0x6a211098
y.create.l HWIO_WCSS_A_QTMR_AC_QTMR_AC_CNTVOFF_LO_4_ADDR A:0x6a2110a0
y.create.l HWIO_WCSS_A_QTMR_AC_QTMR_AC_CNTVOFF_HI_0_ADDR A:0x6a211084
y.create.l HWIO_WCSS_A_QTMR_AC_QTMR_AC_CNTVOFF_HI_1_ADDR A:0x6a21108c
y.create.l HWIO_WCSS_A_QTMR_AC_QTMR_AC_CNTVOFF_HI_2_ADDR A:0x6a211094
y.create.l HWIO_WCSS_A_QTMR_AC_QTMR_AC_CNTVOFF_HI_3_ADDR A:0x6a21109c
y.create.l HWIO_WCSS_A_QTMR_AC_QTMR_AC_CNTVOFF_HI_4_ADDR A:0x6a2110a4
y.create.l HWIO_WCSS_A_QTMR_AC_QTMR_AC_CFG_ADDR A:0x6a211fc0
y.create.l HWIO_WCSS_A_QTMR_AC_QTMR_AC_VERSION_ADDR A:0x6a211fd0
y.create.l HWIO_WCSS_A_QTMR_V1_T0_QTMR_V1_CNTPCT_LO_ADDR A:0x6a212000
y.create.l HWIO_WCSS_A_QTMR_V1_T0_QTMR_V1_CNTPCT_HI_ADDR A:0x6a212004
y.create.l HWIO_WCSS_A_QTMR_V1_T0_QTMR_V1_CNTVCT_LO_ADDR A:0x6a212008
y.create.l HWIO_WCSS_A_QTMR_V1_T0_QTMR_V1_CNTVCT_HI_ADDR A:0x6a21200c
y.create.l HWIO_WCSS_A_QTMR_V1_T0_QTMR_V1_CNTFRQ_ADDR A:0x6a212010
y.create.l HWIO_WCSS_A_QTMR_V1_T0_QTMR_V1_CNTPL0ACR_ADDR A:0x6a212014
y.create.l HWIO_WCSS_A_QTMR_V1_T0_QTMR_V1_CNTVOFF_LO_ADDR A:0x6a212018
y.create.l HWIO_WCSS_A_QTMR_V1_T0_QTMR_V1_CNTVOFF_HI_ADDR A:0x6a21201c
y.create.l HWIO_WCSS_A_QTMR_V1_T0_QTMR_V1_CNTP_CVAL_LO_ADDR A:0x6a212020
y.create.l HWIO_WCSS_A_QTMR_V1_T0_QTMR_V1_CNTP_CVAL_HI_ADDR A:0x6a212024
y.create.l HWIO_WCSS_A_QTMR_V1_T0_QTMR_V1_CNTP_TVAL_ADDR A:0x6a212028
y.create.l HWIO_WCSS_A_QTMR_V1_T0_QTMR_V1_CNTP_CTL_ADDR A:0x6a21202c
y.create.l HWIO_WCSS_A_QTMR_V1_T0_QTMR_V1_CNTV_CVAL_LO_ADDR A:0x6a212030
y.create.l HWIO_WCSS_A_QTMR_V1_T0_QTMR_V1_CNTV_CVAL_HI_ADDR A:0x6a212034
y.create.l HWIO_WCSS_A_QTMR_V1_T0_QTMR_V1_CNTV_TVAL_ADDR A:0x6a212038
y.create.l HWIO_WCSS_A_QTMR_V1_T0_QTMR_V1_CNTV_CTL_ADDR A:0x6a21203c
y.create.l HWIO_WCSS_A_QTMR_V1_T0_QTMR_V1_VERSION_ADDR A:0x6a212fd0
y.create.l HWIO_WCSS_A_QTMR_V1_T1_QTMR_V1_CNTPCT_LO_ADDR A:0x6a213000
y.create.l HWIO_WCSS_A_QTMR_V1_T1_QTMR_V1_CNTPCT_HI_ADDR A:0x6a213004
y.create.l HWIO_WCSS_A_QTMR_V1_T1_QTMR_V1_CNTVCT_LO_ADDR A:0x6a213008
y.create.l HWIO_WCSS_A_QTMR_V1_T1_QTMR_V1_CNTVCT_HI_ADDR A:0x6a21300c
y.create.l HWIO_WCSS_A_QTMR_V1_T1_QTMR_V1_CNTFRQ_ADDR A:0x6a213010
y.create.l HWIO_WCSS_A_QTMR_V1_T1_QTMR_V1_CNTPL0ACR_ADDR A:0x6a213014
y.create.l HWIO_WCSS_A_QTMR_V1_T1_QTMR_V1_CNTVOFF_LO_ADDR A:0x6a213018
y.create.l HWIO_WCSS_A_QTMR_V1_T1_QTMR_V1_CNTVOFF_HI_ADDR A:0x6a21301c
y.create.l HWIO_WCSS_A_QTMR_V1_T1_QTMR_V1_CNTP_CVAL_LO_ADDR A:0x6a213020
y.create.l HWIO_WCSS_A_QTMR_V1_T1_QTMR_V1_CNTP_CVAL_HI_ADDR A:0x6a213024
y.create.l HWIO_WCSS_A_QTMR_V1_T1_QTMR_V1_CNTP_TVAL_ADDR A:0x6a213028
y.create.l HWIO_WCSS_A_QTMR_V1_T1_QTMR_V1_CNTP_CTL_ADDR A:0x6a21302c
y.create.l HWIO_WCSS_A_QTMR_V1_T1_QTMR_V1_CNTV_CVAL_LO_ADDR A:0x6a213030
y.create.l HWIO_WCSS_A_QTMR_V1_T1_QTMR_V1_CNTV_CVAL_HI_ADDR A:0x6a213034
y.create.l HWIO_WCSS_A_QTMR_V1_T1_QTMR_V1_CNTV_TVAL_ADDR A:0x6a213038
y.create.l HWIO_WCSS_A_QTMR_V1_T1_QTMR_V1_CNTV_CTL_ADDR A:0x6a21303c
y.create.l HWIO_WCSS_A_QTMR_V1_T1_QTMR_V1_VERSION_ADDR A:0x6a213fd0
y.create.l HWIO_WCSS_A_QTMR_V1_T2_QTMR_V1_CNTPCT_LO_ADDR A:0x6a214000
y.create.l HWIO_WCSS_A_QTMR_V1_T2_QTMR_V1_CNTPCT_HI_ADDR A:0x6a214004
y.create.l HWIO_WCSS_A_QTMR_V1_T2_QTMR_V1_CNTVCT_LO_ADDR A:0x6a214008
y.create.l HWIO_WCSS_A_QTMR_V1_T2_QTMR_V1_CNTVCT_HI_ADDR A:0x6a21400c
y.create.l HWIO_WCSS_A_QTMR_V1_T2_QTMR_V1_CNTFRQ_ADDR A:0x6a214010
y.create.l HWIO_WCSS_A_QTMR_V1_T2_QTMR_V1_CNTPL0ACR_ADDR A:0x6a214014
y.create.l HWIO_WCSS_A_QTMR_V1_T2_QTMR_V1_CNTVOFF_LO_ADDR A:0x6a214018
y.create.l HWIO_WCSS_A_QTMR_V1_T2_QTMR_V1_CNTVOFF_HI_ADDR A:0x6a21401c
y.create.l HWIO_WCSS_A_QTMR_V1_T2_QTMR_V1_CNTP_CVAL_LO_ADDR A:0x6a214020
y.create.l HWIO_WCSS_A_QTMR_V1_T2_QTMR_V1_CNTP_CVAL_HI_ADDR A:0x6a214024
y.create.l HWIO_WCSS_A_QTMR_V1_T2_QTMR_V1_CNTP_TVAL_ADDR A:0x6a214028
y.create.l HWIO_WCSS_A_QTMR_V1_T2_QTMR_V1_CNTP_CTL_ADDR A:0x6a21402c
y.create.l HWIO_WCSS_A_QTMR_V1_T2_QTMR_V1_CNTV_CVAL_LO_ADDR A:0x6a214030
y.create.l HWIO_WCSS_A_QTMR_V1_T2_QTMR_V1_CNTV_CVAL_HI_ADDR A:0x6a214034
y.create.l HWIO_WCSS_A_QTMR_V1_T2_QTMR_V1_CNTV_TVAL_ADDR A:0x6a214038
y.create.l HWIO_WCSS_A_QTMR_V1_T2_QTMR_V1_CNTV_CTL_ADDR A:0x6a21403c
y.create.l HWIO_WCSS_A_QTMR_V1_T2_QTMR_V1_VERSION_ADDR A:0x6a214fd0
y.create.l HWIO_WCSS_A_QTMR_V1_T3_QTMR_V1_CNTPCT_LO_ADDR A:0x6a215000
y.create.l HWIO_WCSS_A_QTMR_V1_T3_QTMR_V1_CNTPCT_HI_ADDR A:0x6a215004
y.create.l HWIO_WCSS_A_QTMR_V1_T3_QTMR_V1_CNTVCT_LO_ADDR A:0x6a215008
y.create.l HWIO_WCSS_A_QTMR_V1_T3_QTMR_V1_CNTVCT_HI_ADDR A:0x6a21500c
y.create.l HWIO_WCSS_A_QTMR_V1_T3_QTMR_V1_CNTFRQ_ADDR A:0x6a215010
y.create.l HWIO_WCSS_A_QTMR_V1_T3_QTMR_V1_CNTPL0ACR_ADDR A:0x6a215014
y.create.l HWIO_WCSS_A_QTMR_V1_T3_QTMR_V1_CNTVOFF_LO_ADDR A:0x6a215018
y.create.l HWIO_WCSS_A_QTMR_V1_T3_QTMR_V1_CNTVOFF_HI_ADDR A:0x6a21501c
y.create.l HWIO_WCSS_A_QTMR_V1_T3_QTMR_V1_CNTP_CVAL_LO_ADDR A:0x6a215020
y.create.l HWIO_WCSS_A_QTMR_V1_T3_QTMR_V1_CNTP_CVAL_HI_ADDR A:0x6a215024
y.create.l HWIO_WCSS_A_QTMR_V1_T3_QTMR_V1_CNTP_TVAL_ADDR A:0x6a215028
y.create.l HWIO_WCSS_A_QTMR_V1_T3_QTMR_V1_CNTP_CTL_ADDR A:0x6a21502c
y.create.l HWIO_WCSS_A_QTMR_V1_T3_QTMR_V1_CNTV_CVAL_LO_ADDR A:0x6a215030
y.create.l HWIO_WCSS_A_QTMR_V1_T3_QTMR_V1_CNTV_CVAL_HI_ADDR A:0x6a215034
y.create.l HWIO_WCSS_A_QTMR_V1_T3_QTMR_V1_CNTV_TVAL_ADDR A:0x6a215038
y.create.l HWIO_WCSS_A_QTMR_V1_T3_QTMR_V1_CNTV_CTL_ADDR A:0x6a21503c
y.create.l HWIO_WCSS_A_QTMR_V1_T3_QTMR_V1_VERSION_ADDR A:0x6a215fd0
y.create.l HWIO_WCSS_A_QTMR_V1_T4_QTMR_V1_CNTPCT_LO_ADDR A:0x6a216000
y.create.l HWIO_WCSS_A_QTMR_V1_T4_QTMR_V1_CNTPCT_HI_ADDR A:0x6a216004
y.create.l HWIO_WCSS_A_QTMR_V1_T4_QTMR_V1_CNTVCT_LO_ADDR A:0x6a216008
y.create.l HWIO_WCSS_A_QTMR_V1_T4_QTMR_V1_CNTVCT_HI_ADDR A:0x6a21600c
y.create.l HWIO_WCSS_A_QTMR_V1_T4_QTMR_V1_CNTFRQ_ADDR A:0x6a216010
y.create.l HWIO_WCSS_A_QTMR_V1_T4_QTMR_V1_CNTPL0ACR_ADDR A:0x6a216014
y.create.l HWIO_WCSS_A_QTMR_V1_T4_QTMR_V1_CNTVOFF_LO_ADDR A:0x6a216018
y.create.l HWIO_WCSS_A_QTMR_V1_T4_QTMR_V1_CNTVOFF_HI_ADDR A:0x6a21601c
y.create.l HWIO_WCSS_A_QTMR_V1_T4_QTMR_V1_CNTP_CVAL_LO_ADDR A:0x6a216020
y.create.l HWIO_WCSS_A_QTMR_V1_T4_QTMR_V1_CNTP_CVAL_HI_ADDR A:0x6a216024
y.create.l HWIO_WCSS_A_QTMR_V1_T4_QTMR_V1_CNTP_TVAL_ADDR A:0x6a216028
y.create.l HWIO_WCSS_A_QTMR_V1_T4_QTMR_V1_CNTP_CTL_ADDR A:0x6a21602c
y.create.l HWIO_WCSS_A_QTMR_V1_T4_QTMR_V1_CNTV_CVAL_LO_ADDR A:0x6a216030
y.create.l HWIO_WCSS_A_QTMR_V1_T4_QTMR_V1_CNTV_CVAL_HI_ADDR A:0x6a216034
y.create.l HWIO_WCSS_A_QTMR_V1_T4_QTMR_V1_CNTV_TVAL_ADDR A:0x6a216038
y.create.l HWIO_WCSS_A_QTMR_V1_T4_QTMR_V1_CNTV_CTL_ADDR A:0x6a21603c
y.create.l HWIO_WCSS_A_QTMR_V1_T4_QTMR_V1_VERSION_ADDR A:0x6a216fd0
y.create.l HWIO_WCSS_A_QGIC2_GICD_CTLR_ADDR A:0x6a20a000
y.create.l HWIO_WCSS_A_QGIC2_GICD_TYPER_ADDR A:0x6a20a004
y.create.l HWIO_WCSS_A_QGIC2_GICD_IIDR_ADDR A:0x6a20a008
y.create.l HWIO_WCSS_A_QGIC2_GICD_ANSACR_ADDR A:0x6a20a020
y.create.l HWIO_WCSS_A_QGIC2_GICD_CGCR_ADDR A:0x6a20a024
y.create.l HWIO_WCSS_A_QGIC2_GICD_HW_VERSION_ADDR A:0x6a20a030
y.create.l HWIO_WCSS_A_QGIC2_GICD_ISR0_ADDR A:0x6a20a080
y.create.l HWIO_WCSS_A_QGIC2_GICD_ISR1_ADDR A:0x6a20a084
y.create.l HWIO_WCSS_A_QGIC2_GICD_ISR2_ADDR A:0x6a20a088
y.create.l HWIO_WCSS_A_QGIC2_GICD_ISR3_ADDR A:0x6a20a08c
y.create.l HWIO_WCSS_A_QGIC2_GICD_ISR4_ADDR A:0x6a20a090
y.create.l HWIO_WCSS_A_QGIC2_GICD_ISR5_ADDR A:0x6a20a094
y.create.l HWIO_WCSS_A_QGIC2_GICD_ISR6_ADDR A:0x6a20a098
y.create.l HWIO_WCSS_A_QGIC2_GICD_ISR7_ADDR A:0x6a20a09c
y.create.l HWIO_WCSS_A_QGIC2_GICD_ISR8_ADDR A:0x6a20a0a0
y.create.l HWIO_WCSS_A_QGIC2_GICD_ISENABLER0_ADDR A:0x6a20a100
y.create.l HWIO_WCSS_A_QGIC2_GICD_ISENABLER1_ADDR A:0x6a20a104
y.create.l HWIO_WCSS_A_QGIC2_GICD_ISENABLER2_ADDR A:0x6a20a108
y.create.l HWIO_WCSS_A_QGIC2_GICD_ISENABLER3_ADDR A:0x6a20a10c
y.create.l HWIO_WCSS_A_QGIC2_GICD_ISENABLER4_ADDR A:0x6a20a110
y.create.l HWIO_WCSS_A_QGIC2_GICD_ISENABLER5_ADDR A:0x6a20a114
y.create.l HWIO_WCSS_A_QGIC2_GICD_ISENABLER6_ADDR A:0x6a20a118
y.create.l HWIO_WCSS_A_QGIC2_GICD_ISENABLER7_ADDR A:0x6a20a11c
y.create.l HWIO_WCSS_A_QGIC2_GICD_ISENABLER8_ADDR A:0x6a20a120
y.create.l HWIO_WCSS_A_QGIC2_GICD_ICENABLER0_ADDR A:0x6a20a180
y.create.l HWIO_WCSS_A_QGIC2_GICD_ICENABLER1_ADDR A:0x6a20a184
y.create.l HWIO_WCSS_A_QGIC2_GICD_ICENABLER2_ADDR A:0x6a20a188
y.create.l HWIO_WCSS_A_QGIC2_GICD_ICENABLER3_ADDR A:0x6a20a18c
y.create.l HWIO_WCSS_A_QGIC2_GICD_ICENABLER4_ADDR A:0x6a20a190
y.create.l HWIO_WCSS_A_QGIC2_GICD_ICENABLER5_ADDR A:0x6a20a194
y.create.l HWIO_WCSS_A_QGIC2_GICD_ICENABLER6_ADDR A:0x6a20a198
y.create.l HWIO_WCSS_A_QGIC2_GICD_ICENABLER7_ADDR A:0x6a20a19c
y.create.l HWIO_WCSS_A_QGIC2_GICD_ICENABLER8_ADDR A:0x6a20a1a0
y.create.l HWIO_WCSS_A_QGIC2_GICD_ISPENDR0_ADDR A:0x6a20a200
y.create.l HWIO_WCSS_A_QGIC2_GICD_ISPENDR1_ADDR A:0x6a20a204
y.create.l HWIO_WCSS_A_QGIC2_GICD_ISPENDR2_ADDR A:0x6a20a208
y.create.l HWIO_WCSS_A_QGIC2_GICD_ISPENDR3_ADDR A:0x6a20a20c
y.create.l HWIO_WCSS_A_QGIC2_GICD_ISPENDR4_ADDR A:0x6a20a210
y.create.l HWIO_WCSS_A_QGIC2_GICD_ISPENDR5_ADDR A:0x6a20a214
y.create.l HWIO_WCSS_A_QGIC2_GICD_ISPENDR6_ADDR A:0x6a20a218
y.create.l HWIO_WCSS_A_QGIC2_GICD_ISPENDR7_ADDR A:0x6a20a21c
y.create.l HWIO_WCSS_A_QGIC2_GICD_ISPENDR8_ADDR A:0x6a20a220
y.create.l HWIO_WCSS_A_QGIC2_GICD_ICPENDR0_ADDR A:0x6a20a280
y.create.l HWIO_WCSS_A_QGIC2_GICD_ICPENDR1_ADDR A:0x6a20a284
y.create.l HWIO_WCSS_A_QGIC2_GICD_ICPENDR2_ADDR A:0x6a20a288
y.create.l HWIO_WCSS_A_QGIC2_GICD_ICPENDR3_ADDR A:0x6a20a28c
y.create.l HWIO_WCSS_A_QGIC2_GICD_ICPENDR4_ADDR A:0x6a20a290
y.create.l HWIO_WCSS_A_QGIC2_GICD_ICPENDR5_ADDR A:0x6a20a294
y.create.l HWIO_WCSS_A_QGIC2_GICD_ICPENDR6_ADDR A:0x6a20a298
y.create.l HWIO_WCSS_A_QGIC2_GICD_ICPENDR7_ADDR A:0x6a20a29c
y.create.l HWIO_WCSS_A_QGIC2_GICD_ICPENDR8_ADDR A:0x6a20a2a0
y.create.l HWIO_WCSS_A_QGIC2_GICD_ISACTIVER0_ADDR A:0x6a20a300
y.create.l HWIO_WCSS_A_QGIC2_GICD_ISACTIVER1_ADDR A:0x6a20a304
y.create.l HWIO_WCSS_A_QGIC2_GICD_ISACTIVER2_ADDR A:0x6a20a308
y.create.l HWIO_WCSS_A_QGIC2_GICD_ISACTIVER3_ADDR A:0x6a20a30c
y.create.l HWIO_WCSS_A_QGIC2_GICD_ISACTIVER4_ADDR A:0x6a20a310
y.create.l HWIO_WCSS_A_QGIC2_GICD_ISACTIVER5_ADDR A:0x6a20a314
y.create.l HWIO_WCSS_A_QGIC2_GICD_ISACTIVER6_ADDR A:0x6a20a318
y.create.l HWIO_WCSS_A_QGIC2_GICD_ISACTIVER7_ADDR A:0x6a20a31c
y.create.l HWIO_WCSS_A_QGIC2_GICD_ISACTIVER8_ADDR A:0x6a20a320
y.create.l HWIO_WCSS_A_QGIC2_GICD_ICACTIVER0_ADDR A:0x6a20a380
y.create.l HWIO_WCSS_A_QGIC2_GICD_ICACTIVER1_ADDR A:0x6a20a384
y.create.l HWIO_WCSS_A_QGIC2_GICD_ICACTIVER2_ADDR A:0x6a20a388
y.create.l HWIO_WCSS_A_QGIC2_GICD_ICACTIVER3_ADDR A:0x6a20a38c
y.create.l HWIO_WCSS_A_QGIC2_GICD_ICACTIVER4_ADDR A:0x6a20a390
y.create.l HWIO_WCSS_A_QGIC2_GICD_ICACTIVER5_ADDR A:0x6a20a394
y.create.l HWIO_WCSS_A_QGIC2_GICD_ICACTIVER6_ADDR A:0x6a20a398
y.create.l HWIO_WCSS_A_QGIC2_GICD_ICACTIVER7_ADDR A:0x6a20a39c
y.create.l HWIO_WCSS_A_QGIC2_GICD_ICACTIVER8_ADDR A:0x6a20a3a0
y.create.l HWIO_WCSS_A_QGIC2_GICD_IPRIORITYR0_ADDR A:0x6a20a400
y.create.l HWIO_WCSS_A_QGIC2_GICD_IPRIORITYR1_ADDR A:0x6a20a404
y.create.l HWIO_WCSS_A_QGIC2_GICD_IPRIORITYR2_ADDR A:0x6a20a408
y.create.l HWIO_WCSS_A_QGIC2_GICD_IPRIORITYR3_ADDR A:0x6a20a40c
y.create.l HWIO_WCSS_A_QGIC2_GICD_IPRIORITYR4_ADDR A:0x6a20a410
y.create.l HWIO_WCSS_A_QGIC2_GICD_IPRIORITYR5_ADDR A:0x6a20a414
y.create.l HWIO_WCSS_A_QGIC2_GICD_IPRIORITYR6_ADDR A:0x6a20a418
y.create.l HWIO_WCSS_A_QGIC2_GICD_IPRIORITYR7_ADDR A:0x6a20a41c
y.create.l HWIO_WCSS_A_QGIC2_GICD_IPRIORITYR8_ADDR A:0x6a20a420
y.create.l HWIO_WCSS_A_QGIC2_GICD_IPRIORITYR9_ADDR A:0x6a20a424
y.create.l HWIO_WCSS_A_QGIC2_GICD_ITARGETSR0_ADDR A:0x6a20a800
y.create.l HWIO_WCSS_A_QGIC2_GICD_ITARGETSR1_ADDR A:0x6a20a804
y.create.l HWIO_WCSS_A_QGIC2_GICD_ITARGETSR2_ADDR A:0x6a20a808
y.create.l HWIO_WCSS_A_QGIC2_GICD_ITARGETSR3_ADDR A:0x6a20a80c
y.create.l HWIO_WCSS_A_QGIC2_GICD_ITARGETSR4_ADDR A:0x6a20a810
y.create.l HWIO_WCSS_A_QGIC2_GICD_ITARGETSR5_ADDR A:0x6a20a814
y.create.l HWIO_WCSS_A_QGIC2_GICD_ITARGETSR6_ADDR A:0x6a20a818
y.create.l HWIO_WCSS_A_QGIC2_GICD_ITARGETSR7_ADDR A:0x6a20a81c
y.create.l HWIO_WCSS_A_QGIC2_GICD_ITARGETSR8_ADDR A:0x6a20a820
y.create.l HWIO_WCSS_A_QGIC2_GICD_ITARGETSR9_ADDR A:0x6a20a824
y.create.l HWIO_WCSS_A_QGIC2_GICD_ICFGR0_ADDR A:0x6a20ac00
y.create.l HWIO_WCSS_A_QGIC2_GICD_ICFGR1_ADDR A:0x6a20ac04
y.create.l HWIO_WCSS_A_QGIC2_GICD_ICFGR2_ADDR A:0x6a20ac08
y.create.l HWIO_WCSS_A_QGIC2_GICD_ICFGR3_ADDR A:0x6a20ac0c
y.create.l HWIO_WCSS_A_QGIC2_GICD_ICFGR4_ADDR A:0x6a20ac10
y.create.l HWIO_WCSS_A_QGIC2_GICD_ICFGR5_ADDR A:0x6a20ac14
y.create.l HWIO_WCSS_A_QGIC2_GICD_ICFGR6_ADDR A:0x6a20ac18
y.create.l HWIO_WCSS_A_QGIC2_GICD_ICFGR7_ADDR A:0x6a20ac1c
y.create.l HWIO_WCSS_A_QGIC2_GICD_ICFGR8_ADDR A:0x6a20ac20
y.create.l HWIO_WCSS_A_QGIC2_GICD_ICFGR9_ADDR A:0x6a20ac24
y.create.l HWIO_WCSS_A_QGIC2_GICD_SGIR_ADDR A:0x6a20af00
y.create.l HWIO_WCSS_A_QGIC2_GICD_CPENDSGIR0_ADDR A:0x6a20af10
y.create.l HWIO_WCSS_A_QGIC2_GICD_CPENDSGIR1_ADDR A:0x6a20af14
y.create.l HWIO_WCSS_A_QGIC2_GICD_CPENDSGIR2_ADDR A:0x6a20af18
y.create.l HWIO_WCSS_A_QGIC2_GICD_CPENDSGIR3_ADDR A:0x6a20af1c
y.create.l HWIO_WCSS_A_QGIC2_GICD_SPENDSGIR0_ADDR A:0x6a20af20
y.create.l HWIO_WCSS_A_QGIC2_GICD_SPENDSGIR1_ADDR A:0x6a20af24
y.create.l HWIO_WCSS_A_QGIC2_GICD_SPENDSGIR2_ADDR A:0x6a20af28
y.create.l HWIO_WCSS_A_QGIC2_GICD_SPENDSGIR3_ADDR A:0x6a20af2c
y.create.l HWIO_WCSS_A_QGIC2_GICD_PIDR0_ADDR A:0x6a20afd0
y.create.l HWIO_WCSS_A_QGIC2_GICD_PIDR1_ADDR A:0x6a20afd4
y.create.l HWIO_WCSS_A_QGIC2_GICD_PIDR2_ADDR A:0x6a20afd8
y.create.l HWIO_WCSS_A_QGIC2_GICD_PIDR3_ADDR A:0x6a20afdc
y.create.l HWIO_WCSS_A_QGIC2_GICD_PIDR4_ADDR A:0x6a20afe0
y.create.l HWIO_WCSS_A_QGIC2_GICD_PIDR5_ADDR A:0x6a20afe4
y.create.l HWIO_WCSS_A_QGIC2_GICD_PIDR6_ADDR A:0x6a20afe8
y.create.l HWIO_WCSS_A_QGIC2_GICD_PIDR7_ADDR A:0x6a20afec
y.create.l HWIO_WCSS_A_QGIC2_GICD_CIDR0_ADDR A:0x6a20aff0
y.create.l HWIO_WCSS_A_QGIC2_GICD_CIDR1_ADDR A:0x6a20aff4
y.create.l HWIO_WCSS_A_QGIC2_GICD_CIDR2_ADDR A:0x6a20aff8
y.create.l HWIO_WCSS_A_QGIC2_GICD_CIDR3_ADDR A:0x6a20affc
y.create.l HWIO_WCSS_A_QGIC2_GICH_HCR_ADDR A:0x6a20b000
y.create.l HWIO_WCSS_A_QGIC2_GICH_VTR_ADDR A:0x6a20b004
y.create.l HWIO_WCSS_A_QGIC2_GICH_VMCR_ADDR A:0x6a20b008
y.create.l HWIO_WCSS_A_QGIC2_GICH_MISR_ADDR A:0x6a20b010
y.create.l HWIO_WCSS_A_QGIC2_GICH_EISR_ADDR A:0x6a20b020
y.create.l HWIO_WCSS_A_QGIC2_GICH_ELRSR_ADDR A:0x6a20b030
y.create.l HWIO_WCSS_A_QGIC2_GICH_APR_ADDR A:0x6a20b0f0
y.create.l HWIO_WCSS_A_QGIC2_GICH_LR0_ADDR A:0x6a20b100
y.create.l HWIO_WCSS_A_QGIC2_GICH_LR1_ADDR A:0x6a20b104
y.create.l HWIO_WCSS_A_QGIC2_GICH_LR2_ADDR A:0x6a20b108
y.create.l HWIO_WCSS_A_QGIC2_GICH_LR3_ADDR A:0x6a20b10c
y.create.l HWIO_WCSS_A_QGIC2_GICH_SW_LR_ADDR A:0x6a20b120
y.create.l HWIO_WCSS_A_QGIC2_GICC_CTLR_ADDR A:0x6a20c000
y.create.l HWIO_WCSS_A_QGIC2_GICC_PMR_ADDR A:0x6a20c004
y.create.l HWIO_WCSS_A_QGIC2_GICC_BPR_ADDR A:0x6a20c008
y.create.l HWIO_WCSS_A_QGIC2_GICC_IAR_ADDR A:0x6a20c00c
y.create.l HWIO_WCSS_A_QGIC2_GICC_EOIR_ADDR A:0x6a20c010
y.create.l HWIO_WCSS_A_QGIC2_GICC_RPR_ADDR A:0x6a20c014
y.create.l HWIO_WCSS_A_QGIC2_GICC_HPPIR_ADDR A:0x6a20c018
y.create.l HWIO_WCSS_A_QGIC2_GICC_ABPR_ADDR A:0x6a20c01c
y.create.l HWIO_WCSS_A_QGIC2_GICC_AIAR_ADDR A:0x6a20c020
y.create.l HWIO_WCSS_A_QGIC2_GICC_AEOIR_ADDR A:0x6a20c024
y.create.l HWIO_WCSS_A_QGIC2_GICC_AHPPIR_ADDR A:0x6a20c028
y.create.l HWIO_WCSS_A_QGIC2_GICC_APR_ADDR A:0x6a20c0d0
y.create.l HWIO_WCSS_A_QGIC2_GICC_NSAPR_ADDR A:0x6a20c0e0
y.create.l HWIO_WCSS_A_QGIC2_GICC_IIDR_ADDR A:0x6a20c0fc
y.create.l HWIO_WCSS_A_QGIC2_GICC_DIR_ADDR A:0x6a20d000
y.create.l HWIO_WCSS_A_QGIC2_GICV_CTLR_ADDR A:0x6a20e000
y.create.l HWIO_WCSS_A_QGIC2_GICV_PMR_ADDR A:0x6a20e004
y.create.l HWIO_WCSS_A_QGIC2_GICV_BPR_ADDR A:0x6a20e008
y.create.l HWIO_WCSS_A_QGIC2_GICV_IAR_ADDR A:0x6a20e00c
y.create.l HWIO_WCSS_A_QGIC2_GICV_EOIR_ADDR A:0x6a20e010
y.create.l HWIO_WCSS_A_QGIC2_GICV_RPR_ADDR A:0x6a20e014
y.create.l HWIO_WCSS_A_QGIC2_GICV_HPPIR_ADDR A:0x6a20e018
y.create.l HWIO_WCSS_A_QGIC2_GICV_ABPR_ADDR A:0x6a20e01c
y.create.l HWIO_WCSS_A_QGIC2_GICV_AIAR_ADDR A:0x6a20e020
y.create.l HWIO_WCSS_A_QGIC2_GICV_AEOIR_ADDR A:0x6a20e024
y.create.l HWIO_WCSS_A_QGIC2_GICV_AHPPIR_ADDR A:0x6a20e028
y.create.l HWIO_WCSS_A_QGIC2_GICV_APR_ADDR A:0x6a20e0d0
y.create.l HWIO_WCSS_A_QGIC2_GICV_IIDR_ADDR A:0x6a20e0fc
y.create.l HWIO_WCSS_A_QGIC2_GICV_DIR_ADDR A:0x6a20f000
y.create.l HWIO_WCSS_A_LTE_CXM_CXM_WLAN_TX_GRANT_SEL_ADDR A:0x6a208000
y.create.l HWIO_WCSS_A_LTE_CXM_CXM_WLAN_RX_GRANT_SEL_ADDR A:0x6a208004
y.create.l HWIO_WCSS_A_LTE_CXM_CXM_WLAN_TX_RX_GRANT_EN_ADDR A:0x6a208008
y.create.l HWIO_WCSS_A_LTE_CXM_CXM_TIMER_COUNTER_ADDR A:0x6a20800c
y.create.l HWIO_WCSS_A_LTE_CXM_CXM_SW_CAPTURE_CLK_ADDR A:0x6a208014
y.create.l HWIO_WCSS_A_LTE_CXM_CXM_SW_CAPTURE_SEL_ADDR A:0x6a208018
y.create.l HWIO_WCSS_A_LTE_CXM_LTE_CXM_COUNTER_CAPTURED_ADDR A:0x6a20801c
y.create.l HWIO_WCSS_A_LTE_CXM_CXM_CP_INTERRUPT_CTRL_ADDR A:0x6a208020
y.create.l HWIO_WCSS_A_LTE_CXM_CXM_CP_INTERRUPT_MASK_N_ADDR A:0x6a208024
y.create.l HWIO_WCSS_A_LTE_CXM_CXM_CP_INTERRUPT_RESET_N_ADDR A:0x6a208028
y.create.l HWIO_WCSS_A_LTE_CXM_CXM_CP_INTERRUPT_STATUS_ADDR A:0x6a20802c
y.create.l HWIO_WCSS_A_LTE_CXM_CXM_WLAN_TX_GRANT_ENABLE1_ADDR A:0x6a208030
y.create.l HWIO_WCSS_A_LTE_CXM_CXM_WLAN_TX_GRANT_THRESHOLD1_ADDR A:0x6a208034
y.create.l HWIO_WCSS_A_LTE_CXM_CXM_WLAN_TX_GRANT_VALUE1_ADDR A:0x6a208038
y.create.l HWIO_WCSS_A_LTE_CXM_CXM_WLAN_TX_GRANT_ENABLE2_ADDR A:0x6a20803c
y.create.l HWIO_WCSS_A_LTE_CXM_CXM_WLAN_TX_GRANT_THRESHOLD2_ADDR A:0x6a208040
y.create.l HWIO_WCSS_A_LTE_CXM_CXM_WLAN_TX_GRANT_VALUE2_ADDR A:0x6a208044
y.create.l HWIO_WCSS_A_LTE_CXM_CXM_WLAN_RX_GRANT_ENABLE1_ADDR A:0x6a208048
y.create.l HWIO_WCSS_A_LTE_CXM_CXM_WLAN_RX_GRANT_THRESHOLD1_ADDR A:0x6a20804c
y.create.l HWIO_WCSS_A_LTE_CXM_CXM_WLAN_RX_GRANT_VALUE1_ADDR A:0x6a208050
y.create.l HWIO_WCSS_A_LTE_CXM_CXM_WLAN_RX_GRANT_ENABLE2_ADDR A:0x6a208054
y.create.l HWIO_WCSS_A_LTE_CXM_CXM_WLAN_RX_GRANT_THRESHOLD2_ADDR A:0x6a208058
y.create.l HWIO_WCSS_A_LTE_CXM_CXM_WLAN_RX_GRANT_VALUE2_ADDR A:0x6a20805c
y.create.l HWIO_WCSS_A_LTE_CXM_CXM_BT_TX_GRANT_ENABLE1_ADDR A:0x6a208060
y.create.l HWIO_WCSS_A_LTE_CXM_CXM_BT_TX_GRANT_THRESHOLD1_ADDR A:0x6a208064
y.create.l HWIO_WCSS_A_LTE_CXM_CXM_BT_TX_GRANT_VALUE1_ADDR A:0x6a208068
y.create.l HWIO_WCSS_A_LTE_CXM_CXM_BT_TX_GRANT_ENABLE2_ADDR A:0x6a20806c
y.create.l HWIO_WCSS_A_LTE_CXM_CXM_BT_TX_GRANT_THRESHOLD2_ADDR A:0x6a208070
y.create.l HWIO_WCSS_A_LTE_CXM_CXM_BT_TX_GRANT_VALUE2_ADDR A:0x6a208074
y.create.l HWIO_WCSS_A_LTE_CXM_CXM_BT_RX_GRANT_ENABLE1_ADDR A:0x6a208078
y.create.l HWIO_WCSS_A_LTE_CXM_CXM_BT_RX_GRANT_THRESHOLD1_ADDR A:0x6a20807c
y.create.l HWIO_WCSS_A_LTE_CXM_CXM_BT_RX_GRANT_VALUE1_ADDR A:0x6a208080
y.create.l HWIO_WCSS_A_LTE_CXM_CXM_BT_RX_GRANT_ENABLE2_ADDR A:0x6a208084
y.create.l HWIO_WCSS_A_LTE_CXM_CXM_BT_RX_GRANT_THRESHOLD2_ADDR A:0x6a208088
y.create.l HWIO_WCSS_A_LTE_CXM_CXM_BT_RX_GRANT_VALUE2_ADDR A:0x6a20808c
y.create.l HWIO_WCSS_A_LTE_CXM_CXM_BT_RX_TX_GRANT_SEL_ADDR A:0x6a208090
y.create.l HWIO_WCSS_A_LTE_CXM_CXM_BT_TX_RX_GRANT_EN_ADDR A:0x6a208094
y.create.l HWIO_WCSS_A_LTE_CXM_CXM_CP_INTERRUPT_STROBE_0_START_COUNT_ADDR A:0x6a208098
y.create.l HWIO_WCSS_A_LTE_CXM_CXM_CP_INTERRUPT_STROBE_1_START_COUNT_ADDR A:0x6a20809c
y.create.l HWIO_WCSS_A_LTE_CXM_CXM_CP_INTERRUPT_STROBE_2_START_COUNT_ADDR A:0x6a2080a0
y.create.l HWIO_WCSS_A_LTE_CXM_CXM_CP_INTERRUPT_STROBE_3_START_COUNT_ADDR A:0x6a2080a4
y.create.l HWIO_WCSS_A_LTE_CXM_CXM_CP_INTERRUPT_STROBE_0_PERIODICITY_ADDR A:0x6a2080a8
y.create.l HWIO_WCSS_A_LTE_CXM_CXM_CP_INTERRUPT_STROBE_1_PERIODICITY_ADDR A:0x6a2080ac
y.create.l HWIO_WCSS_A_LTE_CXM_CXM_CP_INTERRUPT_STROBE_2_PERIODICITY_ADDR A:0x6a2080b0
y.create.l HWIO_WCSS_A_LTE_CXM_CXM_CP_INTERRUPT_STROBE_3_PERIODICITY_ADDR A:0x6a2080b4
y.create.l HWIO_WCSS_A_LTE_CXM_CXM_WCN_PRIORITY_ENABLES_ADDR A:0x6a2080b8
y.create.l HWIO_WCSS_A_LTE_CXM_CXM_WCN_PRIORITY_THRESHOLD1_ADDR A:0x6a2080bc
y.create.l HWIO_WCSS_A_LTE_CXM_CXM_WCN_PRIORITY_THRESHOLD2_ADDR A:0x6a2080c0
y.create.l HWIO_WCSS_A_LTE_CXM_CXM_LTE_ACTIVE_FRAME_SYNC_VALUE_ADDR A:0x6a2080c4
y.create.l HWIO_WCSS_A_SPDM_AHBTM_CFG_ADDR A:0x6a203000
y.create.l HWIO_WCSS_A_SPDM_AHBTM_C0_CFG0_ADDR A:0x6a203020
y.create.l HWIO_WCSS_A_SPDM_AHBTM_C1_CFG0_ADDR A:0x6a203040
y.create.l HWIO_WCSS_A_SPDM_AHBTM_C2_CFG0_ADDR A:0x6a203060
y.create.l HWIO_WCSS_A_SPDM_AHBTM_C3_CFG0_ADDR A:0x6a203080
y.create.l HWIO_WCSS_A_SPDM_AHBTM_C4_CFG0_ADDR A:0x6a2030a0
y.create.l HWIO_WCSS_A_SPDM_AHBTM_C5_CFG0_ADDR A:0x6a2030c0
y.create.l HWIO_WCSS_A_SPDM_AHBTM_C6_CFG0_ADDR A:0x6a2030e0
y.create.l HWIO_WCSS_A_SPDM_AHBTM_C7_CFG0_ADDR A:0x6a203100
y.create.l HWIO_WCSS_A_SPDM_AHBTM_C0_CFG1_ADDR A:0x6a203024
y.create.l HWIO_WCSS_A_SPDM_AHBTM_C1_CFG1_ADDR A:0x6a203044
y.create.l HWIO_WCSS_A_SPDM_AHBTM_C2_CFG1_ADDR A:0x6a203064
y.create.l HWIO_WCSS_A_SPDM_AHBTM_C3_CFG1_ADDR A:0x6a203084
y.create.l HWIO_WCSS_A_SPDM_AHBTM_C4_CFG1_ADDR A:0x6a2030a4
y.create.l HWIO_WCSS_A_SPDM_AHBTM_C5_CFG1_ADDR A:0x6a2030c4
y.create.l HWIO_WCSS_A_SPDM_AHBTM_C6_CFG1_ADDR A:0x6a2030e4
y.create.l HWIO_WCSS_A_SPDM_AHBTM_C7_CFG1_ADDR A:0x6a203104
y.create.l HWIO_WCSS_A_SPDM_AHBTM_C0_CFG2_ADDR A:0x6a203028
y.create.l HWIO_WCSS_A_SPDM_AHBTM_C1_CFG2_ADDR A:0x6a203048
y.create.l HWIO_WCSS_A_SPDM_AHBTM_C2_CFG2_ADDR A:0x6a203068
y.create.l HWIO_WCSS_A_SPDM_AHBTM_C3_CFG2_ADDR A:0x6a203088
y.create.l HWIO_WCSS_A_SPDM_AHBTM_C4_CFG2_ADDR A:0x6a2030a8
y.create.l HWIO_WCSS_A_SPDM_AHBTM_C5_CFG2_ADDR A:0x6a2030c8
y.create.l HWIO_WCSS_A_SPDM_AHBTM_C6_CFG2_ADDR A:0x6a2030e8
y.create.l HWIO_WCSS_A_SPDM_AHBTM_C7_CFG2_ADDR A:0x6a203108
y.create.l HWIO_WCSS_A_SPDM_AHBTM_C0_CFG3_ADDR A:0x6a20302c
y.create.l HWIO_WCSS_A_SPDM_AHBTM_C1_CFG3_ADDR A:0x6a20304c
y.create.l HWIO_WCSS_A_SPDM_AHBTM_C2_CFG3_ADDR A:0x6a20306c
y.create.l HWIO_WCSS_A_SPDM_AHBTM_C3_CFG3_ADDR A:0x6a20308c
y.create.l HWIO_WCSS_A_SPDM_AHBTM_C4_CFG3_ADDR A:0x6a2030ac
y.create.l HWIO_WCSS_A_SPDM_AHBTM_C5_CFG3_ADDR A:0x6a2030cc
y.create.l HWIO_WCSS_A_SPDM_AHBTM_C6_CFG3_ADDR A:0x6a2030ec
y.create.l HWIO_WCSS_A_SPDM_AHBTM_C7_CFG3_ADDR A:0x6a20310c
y.create.l HWIO_WCSS_A_SPDM_AHBTM_C0_CFG4_ADDR A:0x6a203030
y.create.l HWIO_WCSS_A_SPDM_AHBTM_C1_CFG4_ADDR A:0x6a203050
y.create.l HWIO_WCSS_A_SPDM_AHBTM_C2_CFG4_ADDR A:0x6a203070
y.create.l HWIO_WCSS_A_SPDM_AHBTM_C3_CFG4_ADDR A:0x6a203090
y.create.l HWIO_WCSS_A_SPDM_AHBTM_C4_CFG4_ADDR A:0x6a2030b0
y.create.l HWIO_WCSS_A_SPDM_AHBTM_C5_CFG4_ADDR A:0x6a2030d0
y.create.l HWIO_WCSS_A_SPDM_AHBTM_C6_CFG4_ADDR A:0x6a2030f0
y.create.l HWIO_WCSS_A_SPDM_AHBTM_C7_CFG4_ADDR A:0x6a203110
y.create.l HWIO_WCSS_A_SPDM_AHBTM_C0_CFG5_ADDR A:0x6a203034
y.create.l HWIO_WCSS_A_SPDM_AHBTM_C1_CFG5_ADDR A:0x6a203054
y.create.l HWIO_WCSS_A_SPDM_AHBTM_C2_CFG5_ADDR A:0x6a203074
y.create.l HWIO_WCSS_A_SPDM_AHBTM_C3_CFG5_ADDR A:0x6a203094
y.create.l HWIO_WCSS_A_SPDM_AHBTM_C4_CFG5_ADDR A:0x6a2030b4
y.create.l HWIO_WCSS_A_SPDM_AHBTM_C5_CFG5_ADDR A:0x6a2030d4
y.create.l HWIO_WCSS_A_SPDM_AHBTM_C6_CFG5_ADDR A:0x6a2030f4
y.create.l HWIO_WCSS_A_SPDM_AHBTM_C7_CFG5_ADDR A:0x6a203114
y.create.l HWIO_WCSS_A_SPDM_AHBTM_C0_CFG6_ADDR A:0x6a203038
y.create.l HWIO_WCSS_A_SPDM_AHBTM_C1_CFG6_ADDR A:0x6a203058
y.create.l HWIO_WCSS_A_SPDM_AHBTM_C2_CFG6_ADDR A:0x6a203078
y.create.l HWIO_WCSS_A_SPDM_AHBTM_C3_CFG6_ADDR A:0x6a203098
y.create.l HWIO_WCSS_A_SPDM_AHBTM_C4_CFG6_ADDR A:0x6a2030b8
y.create.l HWIO_WCSS_A_SPDM_AHBTM_C5_CFG6_ADDR A:0x6a2030d8
y.create.l HWIO_WCSS_A_SPDM_AHBTM_C6_CFG6_ADDR A:0x6a2030f8
y.create.l HWIO_WCSS_A_SPDM_AHBTM_C7_CFG6_ADDR A:0x6a203118
y.create.l HWIO_WCSS_A_DXE_0_DMA_CSR_ADDR A:0x6a202000
y.create.l HWIO_WCSS_A_DXE_0_DMA_ENCH_ADDR A:0x6a202004
y.create.l HWIO_WCSS_A_DXE_0_DMA_CH_EN_ADDR A:0x6a202008
y.create.l HWIO_WCSS_A_DXE_0_DMA_CH_DONE_ADDR A:0x6a20200c
y.create.l HWIO_WCSS_A_DXE_0_DMA_CH_ERR_ADDR A:0x6a202010
y.create.l HWIO_WCSS_A_DXE_0_DMA_CH_STOP_ADDR A:0x6a202014
y.create.l HWIO_WCSS_A_DXE_0_INT_MSK_ADDR A:0x6a202018
y.create.l HWIO_WCSS_A_DXE_0_INT_SRC_MSKD_ADDR A:0x6a20201c
y.create.l HWIO_WCSS_A_DXE_0_INT_SRC_RAW_ADDR A:0x6a202020
y.create.l HWIO_WCSS_A_DXE_0_INT_ED_SRC_ADDR A:0x6a202024
y.create.l HWIO_WCSS_A_DXE_0_INT_DONE_SRC_ADDR A:0x6a202028
y.create.l HWIO_WCSS_A_DXE_0_INT_ERR_SRC_ADDR A:0x6a20202c
y.create.l HWIO_WCSS_A_DXE_0_INT_CLR_ADDR A:0x6a202030
y.create.l HWIO_WCSS_A_DXE_0_INT_ED_CLR_ADDR A:0x6a202034
y.create.l HWIO_WCSS_A_DXE_0_INT_DONE_CLR_ADDR A:0x6a202038
y.create.l HWIO_WCSS_A_DXE_0_INT_ERR_CLR_ADDR A:0x6a20203c
y.create.l HWIO_WCSS_A_DXE_0_DMA_CH_PRES_ADDR A:0x6a202040
y.create.l HWIO_WCSS_A_DXE_0_TSTBUS_CTRL_ADDR A:0x6a202044
y.create.l HWIO_WCSS_A_DXE_0_TSTBUS_LOW_ADDR A:0x6a202048
y.create.l HWIO_WCSS_A_DXE_0_TSTBUS_HIGH_ADDR A:0x6a20204c
y.create.l HWIO_WCSS_A_DXE_0_PF_BD_ADDR A:0x6a202050
y.create.l HWIO_WCSS_A_DXE_0_PF_PDU_ADDR A:0x6a202054
y.create.l HWIO_WCSS_A_DXE_0_REVISION_ADDR A:0x6a202058
y.create.l HWIO_WCSS_A_DXE_0_BMU_SB_QDAT_AVAIL_ADDR A:0x6a20205c
y.create.l HWIO_WCSS_A_DXE_0_BMU_SB_PDU_AVAIL_ADDR A:0x6a202060
y.create.l HWIO_WCSS_A_DXE_0_STATE_ADDR A:0x6a202064
y.create.l HWIO_WCSS_A_DXE_0_ARB_CH_MSK_ADDR A:0x6a202068
y.create.l HWIO_WCSS_A_DXE_0_UIF_SB_ADDR A:0x6a20206c
y.create.l HWIO_WCSS_A_DXE_0_TIMESTAMP_ADDR A:0x6a202070
y.create.l HWIO_WCSS_A_DXE_0_ARB_CH_MSK_CLR_ADDR A:0x6a202074
y.create.l HWIO_WCSS_A_DXE_0_CTR_PRES_ADDR A:0x6a202078
y.create.l HWIO_WCSS_A_DXE_0_CTR_CLR_ADDR A:0x6a20207c
y.create.l HWIO_WCSS_A_DXE_0_BD_TMPLTL_ADDR A:0x6a202080
y.create.l HWIO_WCSS_A_DXE_0_BD_TMPLTH_ADDR A:0x6a202084
y.create.l HWIO_WCSS_A_DXE_0_BDT_DAT_START_ADDR A:0x6a202088
y.create.l HWIO_WCSS_A_DXE_0_COUNTER0_ADDR A:0x6a202200
y.create.l HWIO_WCSS_A_DXE_0_COUNTER1_ADDR A:0x6a202204
y.create.l HWIO_WCSS_A_DXE_0_COUNTER2_ADDR A:0x6a202208
y.create.l HWIO_WCSS_A_DXE_0_COUNTER3_ADDR A:0x6a20220c
y.create.l HWIO_WCSS_A_DXE_0_COUNTER4_ADDR A:0x6a202210
y.create.l HWIO_WCSS_A_DXE_0_COUNTER5_ADDR A:0x6a202214
y.create.l HWIO_WCSS_A_DXE_0_COUNTER6_ADDR A:0x6a202218
y.create.l HWIO_WCSS_A_DXE_0_COUNTER7_ADDR A:0x6a20221c
y.create.l HWIO_WCSS_A_DXE_0_CH0_CTRL_ADDR A:0x6a202400
y.create.l HWIO_WCSS_A_DXE_0_CH0_STATUS_ADDR A:0x6a202404
y.create.l HWIO_WCSS_A_DXE_0_CH0_SZ_ADDR A:0x6a202408
y.create.l HWIO_WCSS_A_DXE_0_CH0_SADRL_ADDR A:0x6a20240c
y.create.l HWIO_WCSS_A_DXE_0_CH0_SADRH_ADDR A:0x6a202410
y.create.l HWIO_WCSS_A_DXE_0_CH0_DADRL_ADDR A:0x6a202414
y.create.l HWIO_WCSS_A_DXE_0_CH0_DADRH_ADDR A:0x6a202418
y.create.l HWIO_WCSS_A_DXE_0_CH0_DESCL_ADDR A:0x6a20241c
y.create.l HWIO_WCSS_A_DXE_0_CH0_DESCH_ADDR A:0x6a202420
y.create.l HWIO_WCSS_A_DXE_0_CH0_LST_DESCL_ADDR A:0x6a202424
y.create.l HWIO_WCSS_A_DXE_0_CH0_LST_DESCH_ADDR A:0x6a202428
y.create.l HWIO_WCSS_A_DXE_0_CH0_BD_ADDR A:0x6a20242c
y.create.l HWIO_WCSS_A_DXE_0_CH0_HEAD_ADDR A:0x6a202430
y.create.l HWIO_WCSS_A_DXE_0_CH0_TAIL_ADDR A:0x6a202434
y.create.l HWIO_WCSS_A_DXE_0_CH0_PDU_ADDR A:0x6a202438
y.create.l HWIO_WCSS_A_DXE_0_CH0_TSTMP_ADDR A:0x6a20243c
y.create.l HWIO_WCSS_A_DXE_0_CH1_CTRL_ADDR A:0x6a202440
y.create.l HWIO_WCSS_A_DXE_0_CH1_STATUS_ADDR A:0x6a202444
y.create.l HWIO_WCSS_A_DXE_0_CH1_SZ_ADDR A:0x6a202448
y.create.l HWIO_WCSS_A_DXE_0_CH1_SADRL_ADDR A:0x6a20244c
y.create.l HWIO_WCSS_A_DXE_0_CH1_SADRH_ADDR A:0x6a202450
y.create.l HWIO_WCSS_A_DXE_0_CH1_DADRL_ADDR A:0x6a202454
y.create.l HWIO_WCSS_A_DXE_0_CH1_DADRH_ADDR A:0x6a202458
y.create.l HWIO_WCSS_A_DXE_0_CH1_DESCL_ADDR A:0x6a20245c
y.create.l HWIO_WCSS_A_DXE_0_CH1_DESCH_ADDR A:0x6a202460
y.create.l HWIO_WCSS_A_DXE_0_CH1_LST_DESCL_ADDR A:0x6a202464
y.create.l HWIO_WCSS_A_DXE_0_CH1_LST_DESCH_ADDR A:0x6a202468
y.create.l HWIO_WCSS_A_DXE_0_CH1_BD_ADDR A:0x6a20246c
y.create.l HWIO_WCSS_A_DXE_0_CH1_HEAD_ADDR A:0x6a202470
y.create.l HWIO_WCSS_A_DXE_0_CH1_TAIL_ADDR A:0x6a202474
y.create.l HWIO_WCSS_A_DXE_0_CH1_PDU_ADDR A:0x6a202478
y.create.l HWIO_WCSS_A_DXE_0_CH1_TSTMP_ADDR A:0x6a20247c
y.create.l HWIO_WCSS_A_DXE_0_CH2_CTRL_ADDR A:0x6a202480
y.create.l HWIO_WCSS_A_DXE_0_CH2_STATUS_ADDR A:0x6a202484
y.create.l HWIO_WCSS_A_DXE_0_CH2_SZ_ADDR A:0x6a202488
y.create.l HWIO_WCSS_A_DXE_0_CH2_SADRL_ADDR A:0x6a20248c
y.create.l HWIO_WCSS_A_DXE_0_CH2_SADRH_ADDR A:0x6a202490
y.create.l HWIO_WCSS_A_DXE_0_CH2_DADRL_ADDR A:0x6a202494
y.create.l HWIO_WCSS_A_DXE_0_CH2_DADRH_ADDR A:0x6a202498
y.create.l HWIO_WCSS_A_DXE_0_CH2_DESCL_ADDR A:0x6a20249c
y.create.l HWIO_WCSS_A_DXE_0_CH2_DESCH_ADDR A:0x6a2024a0
y.create.l HWIO_WCSS_A_DXE_0_CH2_LST_DESCL_ADDR A:0x6a2024a4
y.create.l HWIO_WCSS_A_DXE_0_CH2_LST_DESCH_ADDR A:0x6a2024a8
y.create.l HWIO_WCSS_A_DXE_0_CH2_BD_ADDR A:0x6a2024ac
y.create.l HWIO_WCSS_A_DXE_0_CH2_HEAD_ADDR A:0x6a2024b0
y.create.l HWIO_WCSS_A_DXE_0_CH2_TAIL_ADDR A:0x6a2024b4
y.create.l HWIO_WCSS_A_DXE_0_CH2_PDU_ADDR A:0x6a2024b8
y.create.l HWIO_WCSS_A_DXE_0_CH2_TSTMP_ADDR A:0x6a2024bc
y.create.l HWIO_WCSS_A_DXE_0_CH3_CTRL_ADDR A:0x6a2024c0
y.create.l HWIO_WCSS_A_DXE_0_CH3_STATUS_ADDR A:0x6a2024c4
y.create.l HWIO_WCSS_A_DXE_0_CH3_SZ_ADDR A:0x6a2024c8
y.create.l HWIO_WCSS_A_DXE_0_CH3_SADRL_ADDR A:0x6a2024cc
y.create.l HWIO_WCSS_A_DXE_0_CH3_SADRH_ADDR A:0x6a2024d0
y.create.l HWIO_WCSS_A_DXE_0_CH3_DADRL_ADDR A:0x6a2024d4
y.create.l HWIO_WCSS_A_DXE_0_CH3_DADRH_ADDR A:0x6a2024d8
y.create.l HWIO_WCSS_A_DXE_0_CH3_DESCL_ADDR A:0x6a2024dc
y.create.l HWIO_WCSS_A_DXE_0_CH3_DESCH_ADDR A:0x6a2024e0
y.create.l HWIO_WCSS_A_DXE_0_CH3_LST_DESCL_ADDR A:0x6a2024e4
y.create.l HWIO_WCSS_A_DXE_0_CH3_LST_DESCH_ADDR A:0x6a2024e8
y.create.l HWIO_WCSS_A_DXE_0_CH3_BD_ADDR A:0x6a2024ec
y.create.l HWIO_WCSS_A_DXE_0_CH3_HEAD_ADDR A:0x6a2024f0
y.create.l HWIO_WCSS_A_DXE_0_CH3_TAIL_ADDR A:0x6a2024f4
y.create.l HWIO_WCSS_A_DXE_0_CH3_PDU_ADDR A:0x6a2024f8
y.create.l HWIO_WCSS_A_DXE_0_CH3_TSTMP_ADDR A:0x6a2024fc
y.create.l HWIO_WCSS_A_DXE_0_CH4_CTRL_ADDR A:0x6a202500
y.create.l HWIO_WCSS_A_DXE_0_CH4_STATUS_ADDR A:0x6a202504
y.create.l HWIO_WCSS_A_DXE_0_CH4_SZ_ADDR A:0x6a202508
y.create.l HWIO_WCSS_A_DXE_0_CH4_SADRL_ADDR A:0x6a20250c
y.create.l HWIO_WCSS_A_DXE_0_CH4_SADRH_ADDR A:0x6a202510
y.create.l HWIO_WCSS_A_DXE_0_CH4_DADRL_ADDR A:0x6a202514
y.create.l HWIO_WCSS_A_DXE_0_CH4_DADRH_ADDR A:0x6a202518
y.create.l HWIO_WCSS_A_DXE_0_CH4_DESCL_ADDR A:0x6a20251c
y.create.l HWIO_WCSS_A_DXE_0_CH4_DESCH_ADDR A:0x6a202520
y.create.l HWIO_WCSS_A_DXE_0_CH4_LST_DESCL_ADDR A:0x6a202524
y.create.l HWIO_WCSS_A_DXE_0_CH4_LST_DESCH_ADDR A:0x6a202528
y.create.l HWIO_WCSS_A_DXE_0_CH4_BD_ADDR A:0x6a20252c
y.create.l HWIO_WCSS_A_DXE_0_CH4_HEAD_ADDR A:0x6a202530
y.create.l HWIO_WCSS_A_DXE_0_CH4_TAIL_ADDR A:0x6a202534
y.create.l HWIO_WCSS_A_DXE_0_CH4_PDU_ADDR A:0x6a202538
y.create.l HWIO_WCSS_A_DXE_0_CH4_TSTMP_ADDR A:0x6a20253c
y.create.l HWIO_WCSS_A_DXE_0_CH5_CTRL_ADDR A:0x6a202540
y.create.l HWIO_WCSS_A_DXE_0_CH5_STATUS_ADDR A:0x6a202544
y.create.l HWIO_WCSS_A_DXE_0_CH5_SZ_ADDR A:0x6a202548
y.create.l HWIO_WCSS_A_DXE_0_CH5_SADRL_ADDR A:0x6a20254c
y.create.l HWIO_WCSS_A_DXE_0_CH5_SADRH_ADDR A:0x6a202550
y.create.l HWIO_WCSS_A_DXE_0_CH5_DADRL_ADDR A:0x6a202554
y.create.l HWIO_WCSS_A_DXE_0_CH5_DADRH_ADDR A:0x6a202558
y.create.l HWIO_WCSS_A_DXE_0_CH5_DESCL_ADDR A:0x6a20255c
y.create.l HWIO_WCSS_A_DXE_0_CH5_DESCH_ADDR A:0x6a202560
y.create.l HWIO_WCSS_A_DXE_0_CH5_LST_DESCL_ADDR A:0x6a202564
y.create.l HWIO_WCSS_A_DXE_0_CH5_LST_DESCH_ADDR A:0x6a202568
y.create.l HWIO_WCSS_A_DXE_0_CH5_BD_ADDR A:0x6a20256c
y.create.l HWIO_WCSS_A_DXE_0_CH5_HEAD_ADDR A:0x6a202570
y.create.l HWIO_WCSS_A_DXE_0_CH5_TAIL_ADDR A:0x6a202574
y.create.l HWIO_WCSS_A_DXE_0_CH5_PDU_ADDR A:0x6a202578
y.create.l HWIO_WCSS_A_DXE_0_CH5_TSTMP_ADDR A:0x6a20257c
y.create.l HWIO_WCSS_A_DXE_0_CH6_CTRL_ADDR A:0x6a202580
y.create.l HWIO_WCSS_A_DXE_0_CH6_STATUS_ADDR A:0x6a202584
y.create.l HWIO_WCSS_A_DXE_0_CH6_SZ_ADDR A:0x6a202588
y.create.l HWIO_WCSS_A_DXE_0_CH6_SADRL_ADDR A:0x6a20258c
y.create.l HWIO_WCSS_A_DXE_0_CH6_SADRH_ADDR A:0x6a202590
y.create.l HWIO_WCSS_A_DXE_0_CH6_DADRL_ADDR A:0x6a202594
y.create.l HWIO_WCSS_A_DXE_0_CH6_DADRH_ADDR A:0x6a202598
y.create.l HWIO_WCSS_A_DXE_0_CH6_DESCL_ADDR A:0x6a20259c
y.create.l HWIO_WCSS_A_DXE_0_CH6_DESCH_ADDR A:0x6a2025a0
y.create.l HWIO_WCSS_A_DXE_0_CH6_LST_DESCL_ADDR A:0x6a2025a4
y.create.l HWIO_WCSS_A_DXE_0_CH6_LST_DESCH_ADDR A:0x6a2025a8
y.create.l HWIO_WCSS_A_DXE_0_CH6_BD_ADDR A:0x6a2025ac
y.create.l HWIO_WCSS_A_DXE_0_CH6_HEAD_ADDR A:0x6a2025b0
y.create.l HWIO_WCSS_A_DXE_0_CH6_TAIL_ADDR A:0x6a2025b4
y.create.l HWIO_WCSS_A_DXE_0_CH6_PDU_ADDR A:0x6a2025b8
y.create.l HWIO_WCSS_A_DXE_0_CH6_TSTMP_ADDR A:0x6a2025bc
y.create.l HWIO_WCSS_A_DXE_0_CH7_CTRL_ADDR A:0x6a2025c0
y.create.l HWIO_WCSS_A_DXE_0_CH7_STATUS_ADDR A:0x6a2025c4
y.create.l HWIO_WCSS_A_DXE_0_CH7_SZ_ADDR A:0x6a2025c8
y.create.l HWIO_WCSS_A_DXE_0_CH7_SADRL_ADDR A:0x6a2025cc
y.create.l HWIO_WCSS_A_DXE_0_CH7_SADRH_ADDR A:0x6a2025d0
y.create.l HWIO_WCSS_A_DXE_0_CH7_DADRL_ADDR A:0x6a2025d4
y.create.l HWIO_WCSS_A_DXE_0_CH7_DADRH_ADDR A:0x6a2025d8
y.create.l HWIO_WCSS_A_DXE_0_CH7_DESCL_ADDR A:0x6a2025dc
y.create.l HWIO_WCSS_A_DXE_0_CH7_DESCH_ADDR A:0x6a2025e0
y.create.l HWIO_WCSS_A_DXE_0_CH7_LST_DESCL_ADDR A:0x6a2025e4
y.create.l HWIO_WCSS_A_DXE_0_CH7_LST_DESCH_ADDR A:0x6a2025e8
y.create.l HWIO_WCSS_A_DXE_0_CH7_BD_ADDR A:0x6a2025ec
y.create.l HWIO_WCSS_A_DXE_0_CH7_HEAD_ADDR A:0x6a2025f0
y.create.l HWIO_WCSS_A_DXE_0_CH7_TAIL_ADDR A:0x6a2025f4
y.create.l HWIO_WCSS_A_DXE_0_CH7_PDU_ADDR A:0x6a2025f8
y.create.l HWIO_WCSS_A_DXE_0_CH7_TSTMP_ADDR A:0x6a2025fc
y.create.l HWIO_WCSS_A_CMEM_CMEM_INT_ADDR A:0x6a201000
y.create.l HWIO_WCSS_A_CMEM_CMEM_INT_EN_ADDR A:0x6a201004
y.create.l HWIO_WCSS_A_CMEM_CMEM_INT_CLR_ADDR A:0x6a201008
y.create.l HWIO_WCSS_A_CMEM_CMEM_MEM_CFG_ADDR A:0x6a20100c
y.create.l HWIO_WCSS_A_CMEM_CMEM_TRANSBLK_CODE_ADDR A:0x6a201010
y.create.l HWIO_WCSS_A_CMEM_CMEM_TRANSBLK_START_ADDR_ADDR A:0x6a201014
y.create.l HWIO_WCSS_A_CMEM_CMEM_TRANSBLK_END_ADDR_ADDR A:0x6a201018
y.create.l HWIO_WCSS_A_CMEM_CMEM_TRANSBLK_PORT_EN_ADDR A:0x6a20101c
y.create.l HWIO_WCSS_A_CMEM_CMEM_ARB_POLICY_ADDR A:0x6a201020
y.create.l HWIO_WCSS_A_CMEM_CMEM_PRIORITY_ADDR A:0x6a201024
y.create.l HWIO_WCSS_A_CMEM_CMEM_TEST_OUT_SEL_ADDR A:0x6a201028
y.create.l HWIO_WCSS_A_CMEM_CMEM_INVALID_HISTORY_ADDR A:0x6a20102c
y.create.l HWIO_WCSS_A_CMEM_CMEM_INVALID_ADDR0_ADDR A:0x6a201030
y.create.l HWIO_WCSS_A_CMEM_CMEM_INVALID_ADDR1_ADDR A:0x6a201034
y.create.l HWIO_WCSS_A_CMEM_CMEM_INVALID_ADDR2_ADDR A:0x6a201038
y.create.l HWIO_WCSS_A_CMEM_CMEM_INVALID_ADDR3_ADDR A:0x6a20103c
y.create.l HWIO_WCSS_A_CMEM_CMEM_INVALID_CTL_ADDR A:0x6a201040
y.create.l HWIO_WCSS_A_CMEM_CMEM_SPARE_OUT_ADDR A:0x6a201044
y.create.l HWIO_WCSS_A_CMEM_CMEM_CNT_CTRL_ADDR A:0x6a201048
y.create.l HWIO_WCSS_A_CMEM_CMEM_CAHB_BUSY_CNT_ADDR A:0x6a20104c
y.create.l HWIO_WCSS_A_CMEM_CMEM_CAHB_IDLE_CNT_ADDR A:0x6a201050
y.create.l HWIO_WCSS_A_CMEM_CMEM_CAHB_ACTIVE_CNT_ADDR A:0x6a201054
y.create.l HWIO_WCSS_A_CMEM_CMEM_DAHB_BUSY_CNT_ADDR A:0x6a201058
y.create.l HWIO_WCSS_A_CMEM_CMEM_DAHB_IDLE_CNT_ADDR A:0x6a20105c
y.create.l HWIO_WCSS_A_CMEM_CMEM_DAHB_ACTIVE_CNT_ADDR A:0x6a201060
y.create.l HWIO_WCSS_A_CMEM_CMEM_ACPU_BUSY_CNT_ADDR A:0x6a201064
y.create.l HWIO_WCSS_A_CMEM_CMEM_ACPU_IDLE_CNT_ADDR A:0x6a201068
y.create.l HWIO_WCSS_A_CMEM_CMEM_ACPU_ACTIVE_CNT_ADDR A:0x6a20106c
y.create.l HWIO_WCSS_A_CMEM_CMEM_TESTBUS_HI_ADDR A:0x6a201070
y.create.l HWIO_WCSS_A_CMEM_CMEM_TESTBUS_LO_ADDR A:0x6a201074
y.create.l HWIO_WCSS_A_CMEM_CMEM_CLK_GATE_ADDR A:0x6a201078
y.create.l HWIO_WCSS_A_CMEM_CMEM_CAHB_RX_CTL_ADDR A:0x6a20107c
y.create.l HWIO_WCSS_A_CMEM_CMEM_DAHB_RX_CTL_ADDR A:0x6a201080
y.create.l HWIO_WCSS_A_CCAHB_CCAHB_BT_PL_ADDR A:0x6a200000
y.create.l HWIO_WCSS_A_CCAHB_CCAHB_FM_PL_ADDR A:0x6a200004
y.create.l HWIO_WCSS_A_CCAHB_CCAHB_RRI_PL_ADDR A:0x6a200008
y.create.l HWIO_WCSS_A_CCAHB_CCAHB_DXE_PL_ADDR A:0x6a20000c
y.create.l HWIO_WCSS_A_CCAHB_CCAHB_CCPU_PL_ADDR A:0x6a200010
y.create.l HWIO_WCSS_A_CCAHB_CCAHB_A2AB_PL_ADDR A:0x6a200014
y.create.l HWIO_WCSS_A_CCAHB_CCAHB_CBR_PL_ADDR A:0x6a200018
y.create.l HWIO_WCSS_A_CCAHB_CCAHB_DFLT_MST_ADDR A:0x6a200048
y.create.l HWIO_WCSS_A_CCAHB_CCAHB_VERSION_ADDR A:0x6a200090
y.create.l HWIO_WCSS_A_FM_SSBI2_CFG_SSBI2_CTL_ADDR A:0x6a1e0000
y.create.l HWIO_WCSS_A_FM_SSBI2_CFG_SSBI2_INT_ENABLE_ADDR A:0x6a1e0004
y.create.l HWIO_WCSS_A_FM_SSBI2_CFG_SSBI2_PRIORITIES_ADDR A:0x6a1e0008
y.create.l HWIO_WCSS_A_FM_SSBI2_CFG_SSBI2_BANKS_2_3_CTL_ADDR A:0x6a1e000c
y.create.l HWIO_WCSS_A_FM_SSBI2_CFG_SSBI2_ILLEGAL_STATUS_ADDR A:0x6a1e0010
y.create.l HWIO_WCSS_A_FM_SSBI2_CFG_SSBI2_TEST_BUS_CTL_ADDR A:0x6a1e0014
y.create.l HWIO_WCSS_A_FM_SSBI2_CFG_SSBI2_VIT0_ADDR A:0x6a1e0020
y.create.l HWIO_WCSS_A_FM_SSBI2_CFG_SSBI2_VIT1_ADDR A:0x6a1e0024
y.create.l HWIO_WCSS_A_FM_SSBI2_CFG_SSBI2_VIT2_ADDR A:0x6a1e0028
y.create.l HWIO_WCSS_A_FM_SSBI2_CFG_SSBI2_VIT3_ADDR A:0x6a1e002c
y.create.l HWIO_WCSS_A_FM_SSBI2_CFG_SSBI2_VIT4_ADDR A:0x6a1e0030
y.create.l HWIO_WCSS_A_FM_SSBI2_CFG_SSBI2_VIT5_ADDR A:0x6a1e0034
y.create.l HWIO_WCSS_A_FM_SSBI2_CFG_SSBI2_VIT6_ADDR A:0x6a1e0038
y.create.l HWIO_WCSS_A_FM_SSBI2_CFG_SSBI2_PVC_CTL_ADDR A:0x6a1e00a0
y.create.l HWIO_WCSS_A_FM_SSBI2_CFG_SSBI2_PVC_TABLE0_ADDR A:0x6a1e00a4
y.create.l HWIO_WCSS_A_FM_SSBI2_CFG_SSBI2_PVC_TABLE1_ADDR A:0x6a1e00a8
y.create.l HWIO_WCSS_A_FM_SSBI2_CFG_SSBI2_PVC_TABLE2_ADDR A:0x6a1e00ac
y.create.l HWIO_WCSS_A_FM_SSBI2_CFG_SSBI2_PVC_TABLE3_ADDR A:0x6a1e00b0
y.create.l HWIO_WCSS_A_FM_SSBI2_CFG_SSBI2_PVC_TABLE4_ADDR A:0x6a1e00b4
y.create.l HWIO_WCSS_A_FM_SSBI2_CFG_SSBI2_PVC_TABLE5_ADDR A:0x6a1e00b8
y.create.l HWIO_WCSS_A_FM_SSBI2_CFG_SSBI2_PVC_TABLE6_ADDR A:0x6a1e00bc
y.create.l HWIO_WCSS_A_FM_SSBI2_CFG_SSBI2_PVC_TABLE7_ADDR A:0x6a1e00c0
y.create.l HWIO_WCSS_A_FM_SSBI2_CFG_SSBI2_PVC_TABLE8_ADDR A:0x6a1e00c4
y.create.l HWIO_WCSS_A_FM_SSBI2_CFG_SSBI2_PVC_TABLE9_ADDR A:0x6a1e00c8
y.create.l HWIO_WCSS_A_FM_SSBI2_CMD_SSBI2_CMD_ADDR A:0x6a1c0000
y.create.l HWIO_WCSS_A_FM_SSBI2_CMD_SSBI2_RD_STATUS_ADDR A:0x6a1c0004
y.create.l HWIO_WCSS_A_FM_TX_CONTROL_ADDR A:0x6a180000
y.create.l HWIO_WCSS_A_FM_TX_MODULATION_ADDR A:0x6a180004
y.create.l HWIO_WCSS_A_FM_TX_AUDIO_LIMIT_ADDR A:0x6a180008
y.create.l HWIO_WCSS_A_FM_TX_RDS_CONTROL_ADDR A:0x6a18000c
y.create.l HWIO_WCSS_A_FM_TX_RDS_BLK_DATA_A_B_ADDR A:0x6a180010
y.create.l HWIO_WCSS_A_FM_TX_RDS_BLK_DATA_C_D_ADDR A:0x6a180014
y.create.l HWIO_WCSS_A_FM_TX_SOFT_RESET_ADDR A:0x6a180018
y.create.l HWIO_WCSS_A_FM_TX_TMUX_SEL_ADDR A:0x6a18001c
y.create.l HWIO_WCSS_A_FM_RX_CONTROL_ADDR A:0x6a190000
y.create.l HWIO_WCSS_A_FM_RX_SOFT_RESET_ADDR A:0x6a190004
y.create.l HWIO_WCSS_A_FM_RX_TMUX_SEL_ADDR A:0x6a190024
y.create.l HWIO_WCSS_A_FM_RX_DEMOD_GLITCH_THRESHOLD_ADDR A:0x6a190028
y.create.l HWIO_WCSS_A_FM_RX_GLITCH_STOP_SRCH_CNT_ADDR A:0x6a19002c
y.create.l HWIO_WCSS_A_FM_RX_GLITCH_START_SRCH_CNT_ADDR A:0x6a190030
y.create.l HWIO_WCSS_A_FM_RX_GLITCH_BLANK_CNT_TH_ADDR A:0x6a190034
y.create.l HWIO_WCSS_A_FM_RX_PLL_BANK_CHG_STB_ADDR A:0x6a190038
y.create.l HWIO_WCSS_A_FM_RX_PHASE_COMP_BYPASS_ADDR A:0x6a19003c
y.create.l HWIO_WCSS_A_FM_RX_MPX_DCC_CTRL_ADDR A:0x6a190040
y.create.l HWIO_WCSS_A_FM_RX_MPX_DCC_Z_DELAY_REGISTER_ADDR A:0x6a190044
y.create.l HWIO_WCSS_A_FM_RX_PILOT_DET_THRESHOLD_ADDR A:0x6a190048
y.create.l HWIO_WCSS_A_FM_RX_DELTA_R57K_PHASE_ADJUST_ADDR A:0x6a19004c
y.create.l HWIO_WCSS_A_FM_RX_BLEND_WEIGHT_ADDR A:0x6a190050
y.create.l HWIO_WCSS_A_FM_RX_SOFTMUTE_WEIGHT_ADDR A:0x6a190054
y.create.l HWIO_WCSS_A_FM_RX_BLEND_SOFTMUTE_LPF_M_SEL_ADDR A:0x6a190058
y.create.l HWIO_WCSS_A_FM_RX_MS_DECODER_CNTL_ADDR A:0x6a19005c
y.create.l HWIO_WCSS_A_FM_RX_MS_DECODER_STEREO_ON_ADDR A:0x6a190060
y.create.l HWIO_WCSS_A_FM_RX_RDS_CTRL_ADDR A:0x6a190064
y.create.l HWIO_WCSS_A_FM_RX_RDS_IQ_DET_CTRL_ADDR A:0x6a190068
y.create.l HWIO_WCSS_A_FM_RX_RDS_ACQ_MODE_ADDR A:0x6a19006c
y.create.l HWIO_WCSS_A_FM_RX_RDS_TRK_MODE_ADDR A:0x6a190070
y.create.l HWIO_WCSS_A_FM_RX_RDS_STROBE_MARGIN_ADDR A:0x6a190074
y.create.l HWIO_WCSS_A_FM_RX_RDS_MF_LPF_CNT_ADDR A:0x6a190078
y.create.l HWIO_WCSS_A_FM_RX_RDS_IQ_AN_INT_DUR_SEL_ADDR A:0x6a19007c
y.create.l HWIO_WCSS_A_FM_RX_RDS_IQ_ANALYZER_SELECT_ADDR A:0x6a190080
y.create.l HWIO_WCSS_A_FM_RX_RDS_IQ_AN_DET_THRESH_ADDR A:0x6a190084
y.create.l HWIO_WCSS_A_FM_RX_RDS_RECEIVE_MODE_SELECT_ADDR A:0x6a190088
y.create.l HWIO_WCSS_A_FM_RX_RDS_STATUS_ADDR A:0x6a19008c
y.create.l HWIO_WCSS_A_FM_RX_RDS_IQ_BUFFER_ADDR A:0x6a190090
y.create.l HWIO_WCSS_A_FM_RX_RDS_TIME_TRACKING_THRESHOLD_ADDR A:0x6a190094
y.create.l HWIO_WCSS_A_FM_RX_RDS_PEAK_INDEX_ADDR A:0x6a190098
y.create.l HWIO_WCSS_A_FM_RX_RDS_DL_CONFIG_ADDR A:0x6a19009c
y.create.l HWIO_WCSS_A_FM_RX_RDS_T1Q1E_ADDR A:0x6a1900a0
y.create.l HWIO_WCSS_A_FM_RX_RDS_T1Q2E_ADDR A:0x6a1900a4
y.create.l HWIO_WCSS_A_FM_RX_RDS_BLOCK_DATA_0_1_ADDR A:0x6a1900a8
y.create.l HWIO_WCSS_A_FM_RX_RDS_BLOCK_DATA_2_3_ADDR A:0x6a1900ac
y.create.l HWIO_WCSS_A_FM_RX_RDS_BLOCK_STATUS_ADDR A:0x6a1900b0
y.create.l HWIO_WCSS_A_FM_RX_RDS_BLOCK_DATA_RAW_0_ADDR A:0x6a1900b4
y.create.l HWIO_WCSS_A_FM_RX_RDS_BLOCK_DATA_RAW_1_ADDR A:0x6a1900b8
y.create.l HWIO_WCSS_A_FM_RX_RDS_BLOCK_DATA_RAW_2_ADDR A:0x6a1900bc
y.create.l HWIO_WCSS_A_FM_RX_RDS_BLOCK_DATA_RAW_3_ADDR A:0x6a1900c0
y.create.l HWIO_WCSS_A_FM_RX_RDS_TMUX_SEL_ADDR A:0x6a1900c4
y.create.l HWIO_WCSS_A_FM_RX_BLENDING_READBACK_ADDR A:0x6a1900c8
y.create.l HWIO_WCSS_A_FM_RX_MUTE_READBACK_ADDR A:0x6a1900cc
y.create.l HWIO_WCSS_A_FM_RX_PLL_FREERUN_EN_ADDR A:0x6a1900d0
y.create.l HWIO_WCSS_A_FM_RX_ROT_CTRL_0_ADDR A:0x6a1900d4
y.create.l HWIO_WCSS_A_FM_SPUR_COMP_FIXED_VALUE_0_ADDR A:0x6a1900d8
y.create.l HWIO_WCSS_A_FM_DEMOD_DC_IF_OFFSET_ADDR A:0x6a1900e0
y.create.l HWIO_WCSS_A_FM_SPUR_COMP_DC_VALUE_RD_BACK_0_ADDR A:0x6a1900e4
y.create.l HWIO_WCSS_A_FM_SPUR_TRACK_INPUT_SEL_ADDR A:0x6a190118
y.create.l HWIO_WCSS_A_FM_SPUR_TRACK_CMD_STATUS_ADDR A:0x6a19011c
y.create.l HWIO_WCSS_A_FM_RX_ROT_CTRL_1_ADDR A:0x6a190120
y.create.l HWIO_WCSS_A_FM_SPUR_COMP_FIXED_VALUE_1_ADDR A:0x6a190124
y.create.l HWIO_WCSS_A_FM_SPUR_COMP_DC_VALUE_RD_BACK_1_ADDR A:0x6a190128
y.create.l HWIO_WCSS_A_FM_RX_ROT_CTRL_2_ADDR A:0x6a19012c
y.create.l HWIO_WCSS_A_FM_SPUR_COMP_FIXED_VALUE_2_ADDR A:0x6a190130
y.create.l HWIO_WCSS_A_FM_SPUR_COMP_DC_VALUE_RD_BACK_2_ADDR A:0x6a190134
y.create.l HWIO_WCSS_A_FM_GAS_GAM_CTRL_ADDR A:0x6a1a0000
y.create.l HWIO_WCSS_A_FM_FM_INTR_EVENT_ADDR A:0x6a1a0004
y.create.l HWIO_WCSS_A_FM_FM_INTR_ENABLE_ADDR A:0x6a1a0008
y.create.l HWIO_WCSS_A_FM_FM_BUFFER_START_ADDRESS_ADDR A:0x6a1a000c
y.create.l HWIO_WCSS_A_FM_FM_BUFFER_LENGTH_ADDR A:0x6a1a0010
y.create.l HWIO_WCSS_A_FM_FM_BUFFER_HEAD_ADDR A:0x6a1a0014
y.create.l HWIO_WCSS_A_FM_FM_BUFFER_TAIL_ADDR A:0x6a1a0018
y.create.l HWIO_WCSS_A_FM_AUDIO_INTR_CONTROL_ADDR A:0x6a1a001c
y.create.l HWIO_WCSS_A_FM_CLR_AUDIO_LEVEL_INTR_ADDR A:0x6a1a0020
y.create.l HWIO_WCSS_A_FM_AUDIO_SAMPLES_COUNTER_VFR_SNAP_READBACK_ADDR A:0x6a1a0024
y.create.l HWIO_WCSS_A_FM_AUDIO_SAMPLES_COUNTER_READBACK_ADDR A:0x6a1a0028
y.create.l HWIO_WCSS_A_FM_SW_RESET_ADDR A:0x6a1a002c
y.create.l HWIO_WCSS_A_FM_RIVA_TEST_MUX_ADDR A:0x6a1a0030
y.create.l HWIO_WCSS_A_FM_SDI_CTRL_ADDR A:0x6a1a0034
y.create.l HWIO_WCSS_A_FM_SCRAMBLER_CTRL_ADDR A:0x6a1a0038
y.create.l HWIO_WCSS_A_FM_SCRAMBLER_POLY_ADDR A:0x6a1a003c
y.create.l HWIO_WCSS_A_FM_FM_INTR_CTRL_ADDR A:0x6a1a0040
y.create.l HWIO_WCSS_A_FM_AUDIO_DATA_CONTROL_ADDR A:0x6a1a0044
y.create.l HWIO_WCSS_A_FM_FM_HW_VERSION_ADDR A:0x6a1a0048
y.create.l HWIO_WCSS_A_FM_SPUR_TRK_START_ADDRESS_ADDR A:0x6a1a0090
y.create.l HWIO_WCSS_A_FM_RX_AHB_ACCESS_ERROR_STATUS_ADDR A:0x6a1a0094
y.create.l HWIO_WCSS_A_A2XB_A2XB_CFG_ADDR A:0x6a100400
y.create.l HWIO_WCSS_A_A2XB_INT_MSK_ADDR A:0x6a100404
y.create.l HWIO_WCSS_A_A2XB_INT_SRC_MSKD_ADDR A:0x6a100408
y.create.l HWIO_WCSS_A_A2XB_INT_SRC_ADDR A:0x6a10040c
y.create.l HWIO_WCSS_A_A2XB_INT_CLR_ADDR A:0x6a100410
y.create.l HWIO_WCSS_A_A2XB_TSTBUS_CTRL_ADDR A:0x6a100414
y.create.l HWIO_WCSS_A_A2XB_TSTBUS_ADDR A:0x6a100418
y.create.l HWIO_WCSS_A_A2XB_ERR_INFO_ADDR A:0x6a10041c
y.create.l HWIO_WCSS_A_A2XB_REVISION_ADDR A:0x6a100420
y.create.l HWIO_WCSS_A_A2XB_SPARE_ADDR A:0x6a100424
y.create.l HWIO_WCSS_A_A2XB_HALT_ADDR A:0x6a100428
y.create.l HWIO_WCSS_A_A2XB_AXI_SB_CFG_ADDR A:0x6a10042c
y.create.l HWIO_WCSS_A_ADU_CONTROL_ADDR A:0x6a082800
y.create.l HWIO_WCSS_A_ADU_INTERRUPT_STATUS_ADDR A:0x6a082804
y.create.l HWIO_WCSS_A_ADU_INTERRUPT_ENABLE_ADDR A:0x6a082808
y.create.l HWIO_WCSS_A_ADU_ADU_TEST_CTRL_ADDR A:0x6a08280c
y.create.l HWIO_WCSS_A_ADU_ADU_STATUS_ADDR A:0x6a082810
y.create.l HWIO_WCSS_A_ADU_ADU_DEBUG0_ADDR A:0x6a082814
y.create.l HWIO_WCSS_A_ADU_ADU_DEBUG1_ADDR A:0x6a082818
y.create.l HWIO_WCSS_A_ADU_ADU_DEBUG2_ADDR A:0x6a08281c
y.create.l HWIO_WCSS_A_ADU_ADU_COUNTERS1_ADDR A:0x6a082820
y.create.l HWIO_WCSS_A_ADU_ADU_COUNTERS2_ADDR A:0x6a082824
y.create.l HWIO_WCSS_A_ADU_ADU_COUNTERS3_ADDR A:0x6a082828
y.create.l HWIO_WCSS_A_ADU_CONTROL2_ADDR A:0x6a08282c
y.create.l HWIO_WCSS_A_ADU_TIMEOUT_READ_ADDR A:0x6a082830
y.create.l HWIO_WCSS_A_ADU_UMA_CONFIG_ADDR A:0x6a08283c
y.create.l HWIO_WCSS_A_ADU_UMA_CTRL_ADDR A:0x6a082840
y.create.l HWIO_WCSS_A_ADU_UMA_DESP_TABLE_ADDR_ADDR A:0x6a082844
y.create.l HWIO_WCSS_A_ADU_UMA_TX_ETHERTYPE_TABLE1_ADDR A:0x6a082848
y.create.l HWIO_WCSS_A_ADU_UMA_TX_ETHERTYPE_TABLE2_ADDR A:0x6a08284c
y.create.l HWIO_WCSS_A_ADU_UMA_RX_ETHERTYPE_TABLE1_ADDR A:0x6a082850
y.create.l HWIO_WCSS_A_ADU_UMA_RX_ETHERTYPE_TABLE2_ADDR A:0x6a082854
y.create.l HWIO_WCSS_A_ADU_UMA_TX_COUNTERS1_ADDR A:0x6a082858
y.create.l HWIO_WCSS_A_ADU_UMA_TX_COUNTERS2_ADDR A:0x6a08285c
y.create.l HWIO_WCSS_A_ADU_UMA_LLC_COUNTERS_ADDR A:0x6a082860
y.create.l HWIO_WCSS_A_ADU_UMA_INDEX_TABLE_WDATA_U_ADDR A:0x6a082864
y.create.l HWIO_WCSS_A_ADU_UMA_INDEX_TABLE_WDATA_L_ADDR A:0x6a082868
y.create.l HWIO_WCSS_A_ADU_UMA_INDEX_TABLE_ADDR_CTRL_ADDR A:0x6a08286c
y.create.l HWIO_WCSS_A_ADU_UMA_INDEX_TABLE_RDATA_U_ADDR A:0x6a082870
y.create.l HWIO_WCSS_A_ADU_UMA_INDEX_TABLE_RDATA_L_ADDR A:0x6a082874
y.create.l HWIO_WCSS_A_ADU_UMA_TX_DEFAULT_WMACADDR_U_ADDR A:0x6a082878
y.create.l HWIO_WCSS_A_ADU_UMA_TX_DEFAULT_WMACADDR_L_ADDR A:0x6a08287c
y.create.l HWIO_WCSS_A_ADU_UMA_CTRL2_ADDR A:0x6a082880
y.create.l HWIO_WCSS_A_ADU_UMA_TX_COUNTERS3_ADDR A:0x6a082884
y.create.l HWIO_WCSS_A_ADU_UMA_TX_WQ_QID_CTRL_ADDR A:0x6a0828b8
y.create.l HWIO_WCSS_A_ADU_ADU_POLL_CMD_ERROR_ADDR_ADDR A:0x6a0828c0
y.create.l HWIO_WCSS_A_ADU_ADU_SW_REG_REINIT_ADDR_ADDR A:0x6a0828c4
y.create.l HWIO_WCSS_A_ADU_ADU_SW_REG_REINIT_TRIGGER_ADDR A:0x6a0828c8
y.create.l HWIO_WCSS_A_ADU_UMA_TX_HTC_HT_ADDR A:0x6a0828cc
y.create.l HWIO_WCSS_A_ADU_UMA_TX_HTC_VHT_ADDR A:0x6a0828d0
y.create.l HWIO_WCSS_A_ADU_UMA_TX_TID_TO_QID_ADDR A:0x6a0828d4
y.create.l HWIO_WCSS_A_ADU_UMA_TX_DEFAULT_WMACADDR_U_1_ADDR A:0x6a0828d8
y.create.l HWIO_WCSS_A_ADU_UMA_TX_DEFAULT_WMACADDR_L_1_ADDR A:0x6a0828dc
y.create.l HWIO_WCSS_A_ADU_UMA_TX_DEFAULT_WMACADDR_U_2_ADDR A:0x6a0828e0
y.create.l HWIO_WCSS_A_ADU_UMA_TX_DEFAULT_WMACADDR_L_2_ADDR A:0x6a0828e4
y.create.l HWIO_WCSS_A_ADU_UMA_TX_DEFAULT_WMACADDR_U_3_ADDR A:0x6a0828e8
y.create.l HWIO_WCSS_A_ADU_UMA_TX_DEFAULT_WMACADDR_L_3_ADDR A:0x6a0828ec
y.create.l HWIO_WCSS_A_ADU_UMA_TX_DEFAULT_STAID_ADDR A:0x6a0828f0
y.create.l HWIO_WCSS_A_ADU_ADU_REINIT_CONFIG_ADDR A:0x6a0828f4
y.create.l HWIO_WCSS_A_ADU_ADU_NON_AMSDU_LEN_ADDR A:0x6a0828f8
y.create.l HWIO_WCSS_A_AGC_AGC_RESET_ADDR A:0x6a013c00
y.create.l HWIO_WCSS_A_AGC_DIS_MODE_ADDR A:0x6a013c04
y.create.l HWIO_WCSS_A_AGC_RX_OVERRIDE_ADDR A:0x6a013c08
y.create.l HWIO_WCSS_A_AGC_PHY_LOOPBACK_ADDR A:0x6a013c0c
y.create.l HWIO_WCSS_A_AGC_CONFIG_XBAR_ADDR A:0x6a013c10
y.create.l HWIO_WCSS_A_AGC_CW_DETECT_ADDR A:0x6a013c14
y.create.l HWIO_WCSS_A_AGC_CW_NOTCH_TIMEOUT_ADDR A:0x6a013c18
y.create.l HWIO_WCSS_A_AGC_GAIN_MODE_ADDR A:0x6a013c1c
y.create.l HWIO_WCSS_A_AGC_TESTBUS_ADDR A:0x6a013c20
y.create.l HWIO_WCSS_A_AGC_GAINSET0_ADDR A:0x6a013c24
y.create.l HWIO_WCSS_A_AGC_GAINSET_WRITE_ADDR A:0x6a013c28
y.create.l HWIO_WCSS_A_AGC_STAT_CTRL_ADDR A:0x6a013c2c
y.create.l HWIO_WCSS_A_AGC_SUBBAND_CONFIG_ADDR A:0x6a013c30
y.create.l HWIO_WCSS_A_AGC_CHANNEL_FREQ_ADDR A:0x6a013c34
y.create.l HWIO_WCSS_A_AGC_N_ACTIVE_ADDR A:0x6a013c38
y.create.l HWIO_WCSS_A_AGC_N_LISTEN_ADDR A:0x6a013c3c
y.create.l HWIO_WCSS_A_AGC_N_MEASURE_ADDR A:0x6a013c40
y.create.l HWIO_WCSS_A_AGC_N_CAPTURE_ADDR A:0x6a013c44
y.create.l HWIO_WCSS_A_AGC_CCA_MODE_ADDR A:0x6a013c48
y.create.l HWIO_WCSS_A_AGC_CCA_GI_DET_CFG_ADDR A:0x6a013c4c
y.create.l HWIO_WCSS_A_AGC_TH_CD20_ADDR A:0x6a013c50
y.create.l HWIO_WCSS_A_AGC_TH_CD40_ADDR A:0x6a013c54
y.create.l HWIO_WCSS_A_AGC_TH_CD80_ADDR A:0x6a013c58
y.create.l HWIO_WCSS_A_AGC_TH_CS20_ADDR A:0x6a013c5c
y.create.l HWIO_WCSS_A_AGC_TH_CS40_ADDR A:0x6a013c60
y.create.l HWIO_WCSS_A_AGC_TH_CS80_ADDR A:0x6a013c64
y.create.l HWIO_WCSS_A_AGC_TH_EDET_ADDR A:0x6a013c68
y.create.l HWIO_WCSS_A_AGC_D_AGC_A_ADDR A:0x6a013c6c
y.create.l HWIO_WCSS_A_AGC_D_AGC_B_ADDR A:0x6a013c70
y.create.l HWIO_WCSS_A_AGC_RSSI_OFFSET0_ADDR A:0x6a013c74
y.create.l HWIO_WCSS_A_AGC_RSSI_BT_OFFSET0_ADDR A:0x6a013c78
y.create.l HWIO_WCSS_A_AGC_CLIP_COUNT_ADDR A:0x6a013c7c
y.create.l HWIO_WCSS_A_AGC_SAT_COUNT_ADDR A:0x6a013c80
y.create.l HWIO_WCSS_A_AGC_PIP_COUNT_ADDR A:0x6a013c84
y.create.l HWIO_WCSS_A_AGC_RXA_NOT_AVALID_COUNT_ADDR A:0x6a013c88
y.create.l HWIO_WCSS_A_AGC_RXA_HDR_INVALID_COUNT_ADDR A:0x6a013c8c
y.create.l HWIO_WCSS_A_AGC_RXB_NO_B_PKT_DET_COUNT_ADDR A:0x6a013c90
y.create.l HWIO_WCSS_A_AGC_RXB_INV_HDR_COUNT_ADDR A:0x6a013c94
y.create.l HWIO_WCSS_A_AGC_RXB_ILL_HDR_COUNT_ADDR A:0x6a013c98
y.create.l HWIO_WCSS_A_AGC_COARSE_DCO_UPDATE_COUNTER_ADDR A:0x6a013c9c
y.create.l HWIO_WCSS_A_AGC_FALSE_AC_ABORT_COUNT_ADDR A:0x6a013ca0
y.create.l HWIO_WCSS_A_AGC_LATE_AC_DET_COUNT_ADDR A:0x6a013ca4
y.create.l HWIO_WCSS_A_AGC_CCA_PKTDET_STATUS_ADDR A:0x6a013ca8
y.create.l HWIO_WCSS_A_AGC_SAMPLE_ADC_I0_ADDR A:0x6a013cac
y.create.l HWIO_WCSS_A_AGC_SAMPLE_ADC_Q0_ADDR A:0x6a013cb0
y.create.l HWIO_WCSS_A_AGC_ADC_RSSI0_ADDR A:0x6a013cb4
y.create.l HWIO_WCSS_A_AGC_FIR_RSSI0_ADDR A:0x6a013cb8
y.create.l HWIO_WCSS_A_AGC_COARSE_DCO_CHAIN0_REAL_ADDR A:0x6a013cbc
y.create.l HWIO_WCSS_A_AGC_COARSE_DCO_CHAIN0_IMAG_ADDR A:0x6a013cc0
y.create.l HWIO_WCSS_A_AGC_INIT_GAIN_ADDR A:0x6a013cc4
y.create.l HWIO_WCSS_A_AGC_MAX_GAIN_ADDR A:0x6a013cc8
y.create.l HWIO_WCSS_A_AGC_GAIN_OFFSET0_ADDR A:0x6a013ccc
y.create.l HWIO_WCSS_A_AGC_TR_SW_GAIN_THRESH0_ADDR A:0x6a013cd0
y.create.l HWIO_WCSS_A_AGC_SAT_STEP_ADDR A:0x6a013cd4
y.create.l HWIO_WCSS_A_AGC_COARSE_STEP_HT_ADDR A:0x6a013cd8
y.create.l HWIO_WCSS_A_AGC_COARSE_STEP_ADDR A:0x6a013cdc
y.create.l HWIO_WCSS_A_AGC_MAX_POWER_DIFF_ADDR A:0x6a013ce0
y.create.l HWIO_WCSS_A_AGC_TARGET_BO_ACTIVE_ADDR A:0x6a013ce4
y.create.l HWIO_WCSS_A_AGC_TARGET_BO_INACTIVE_ADDR A:0x6a013ce8
y.create.l HWIO_WCSS_A_AGC_TH_CLIP_HIGH_ADDR A:0x6a013cec
y.create.l HWIO_WCSS_A_AGC_TH_CLIP_LOW_ADDR A:0x6a013cf0
y.create.l HWIO_WCSS_A_AGC_TH_SIGNAL_HIGH_ADDR A:0x6a013cf4
y.create.l HWIO_WCSS_A_AGC_TH_SIGNAL_LOW_ADDR A:0x6a013cf8
y.create.l HWIO_WCSS_A_AGC_TH_HTSTS_CLIP_ADDR A:0x6a013cfc
y.create.l HWIO_WCSS_A_AGC_TH_VHTSTS_CLIP_ADDR A:0x6a013d00
y.create.l HWIO_WCSS_A_AGC_TH_POWER_CLIP_ADDR A:0x6a013d04
y.create.l HWIO_WCSS_A_AGC_SAT_DELAY_ADDR A:0x6a013d08
y.create.l HWIO_WCSS_A_AGC_CLIP_WINDOW_ADDR A:0x6a013d0c
y.create.l HWIO_WCSS_A_AGC_TH_NO_SIGNAL_ADDR A:0x6a013d10
y.create.l HWIO_WCSS_A_AGC_TH_DCO_CAL_ADDR A:0x6a013d14
y.create.l HWIO_WCSS_A_AGC_DET_DATA_SHIFT_ADDR A:0x6a013d18
y.create.l HWIO_WCSS_A_AGC_TH_RXB_PWR_HIGH_ADDR A:0x6a013d1c
y.create.l HWIO_WCSS_A_AGC_TH_CW_LOW_ADDR A:0x6a013d20
y.create.l HWIO_WCSS_A_AGC_TH_CW_HIGH_ADDR A:0x6a013d24
y.create.l HWIO_WCSS_A_AGC_TH_CW_RSSI_ADDR A:0x6a013d28
y.create.l HWIO_WCSS_A_AGC_CW_MODE_DELAY_ADDR A:0x6a013d2c
y.create.l HWIO_WCSS_A_AGC_TH_D0_A_ADDR A:0x6a013d30
y.create.l HWIO_WCSS_A_AGC_TH_D0_A_LOW_ADDR A:0x6a013d34
y.create.l HWIO_WCSS_A_AGC_TH_D0_B_ADDR A:0x6a013d38
y.create.l HWIO_WCSS_A_AGC_TH_D0_B_TF_EST_ADDR A:0x6a013d3c
y.create.l HWIO_WCSS_A_AGC_TH_D0_11N_ADDR A:0x6a013d40
y.create.l HWIO_WCSS_A_AGC_TH_D0_11N_LOW_ADDR A:0x6a013d44
y.create.l HWIO_WCSS_A_AGC_TH_D0_11AC_ADDR A:0x6a013d48
y.create.l HWIO_WCSS_A_AGC_TH_D0_11AC_LOW_ADDR A:0x6a013d4c
y.create.l HWIO_WCSS_A_AGC_TH_MAXCORBA_ADDR A:0x6a013d50
y.create.l HWIO_WCSS_A_AGC_TH_MAXCOR40_ADDR A:0x6a013d54
y.create.l HWIO_WCSS_A_AGC_TH_MAXCORA40_ADDR A:0x6a013d58
y.create.l HWIO_WCSS_A_AGC_TH_MAXCOR20_ADDR A:0x6a013d5c
y.create.l HWIO_WCSS_A_AGC_TH_MAXCORA80_ADDR A:0x6a013d60
y.create.l HWIO_WCSS_A_AGC_TH_MAXCORAB_ADDR A:0x6a013d64
y.create.l HWIO_WCSS_A_AGC_C11B_ADDR A:0x6a013d68
y.create.l HWIO_WCSS_A_AGC_C11BP_ADDR A:0x6a013d6c
y.create.l HWIO_WCSS_A_AGC_TH_CAP_A_ADDR A:0x6a013d70
y.create.l HWIO_WCSS_A_AGC_TH_CAP_B_ADDR A:0x6a013d74
y.create.l HWIO_WCSS_A_AGC_TH_CAP_RXA_ADDR A:0x6a013d78
y.create.l HWIO_WCSS_A_AGC_TH_CAP_RXB_ADDR A:0x6a013d7c
y.create.l HWIO_WCSS_A_AGC_TH_PIP_PWR_JUMP_ADDR A:0x6a013d80
y.create.l HWIO_WCSS_A_AGC_TH_EOP_LVL_DROP_ADDR A:0x6a013d84
y.create.l HWIO_WCSS_A_AGC_TH_CORR_DROP_ADDR A:0x6a013d88
y.create.l HWIO_WCSS_A_AGC_CORR_TIME_ADDR A:0x6a013d8c
y.create.l HWIO_WCSS_A_AGC_ALL_RX_ON_TIME_ADDR A:0x6a013d90
y.create.l HWIO_WCSS_A_AGC_TRIGGER_DELAY_ADDR A:0x6a013d94
y.create.l HWIO_WCSS_A_AGC_PWR_NOTCH_ALPHA1_ADDR A:0x6a013d98
y.create.l HWIO_WCSS_A_AGC_PWR_NOTCH_ALPHA2_ADDR A:0x6a013d9c
y.create.l HWIO_WCSS_A_AGC_PWR_NOTCH_T_ALPHA_ADDR A:0x6a013da0
y.create.l HWIO_WCSS_A_AGC_D_TX_SETTLE_ADDR A:0x6a013da4
y.create.l HWIO_WCSS_A_AGC_D_UNSATURATED_ADDR A:0x6a013da8
y.create.l HWIO_WCSS_A_AGC_D_SATURATED_ADDR A:0x6a013dac
y.create.l HWIO_WCSS_A_AGC_D_FIRANDCAL_ADDR A:0x6a013db0
y.create.l HWIO_WCSS_A_AGC_D_HT_STS_COARSE_MEAS_ADDR A:0x6a013db4
y.create.l HWIO_WCSS_A_AGC_D_HT_STS_FINE_MEAS_ADDR A:0x6a013db8
y.create.l HWIO_WCSS_A_AGC_D_VHT_STS_COARSE_MEAS_ADDR A:0x6a013dbc
y.create.l HWIO_WCSS_A_AGC_D_VHT_STS_FINE_MEAS_ADDR A:0x6a013dc0
y.create.l HWIO_WCSS_A_AGC_D_VHT_DET_TIME_ADDR A:0x6a013dc4
y.create.l HWIO_WCSS_A_AGC_SIFS_TIME_A_ADDR A:0x6a013dc8
y.create.l HWIO_WCSS_A_AGC_SIFS_TIME_B_ADDR A:0x6a013dcc
y.create.l HWIO_WCSS_A_AGC_MAX_RX_TIME_A_ADDR A:0x6a013dd0
y.create.l HWIO_WCSS_A_AGC_MAX_RX_TIME_B_ADDR A:0x6a013dd4
y.create.l HWIO_WCSS_A_AGC_RTT_CFG_ADDR A:0x6a013dd8
y.create.l HWIO_WCSS_A_AGC_RTT_SIFS_WINDOW_ADDR A:0x6a013ddc
y.create.l HWIO_WCSS_A_AGC_RTT_OFFSET_20_ADDR A:0x6a013de0
y.create.l HWIO_WCSS_A_AGC_RTT_OFFSET_40_ADDR A:0x6a013de4
y.create.l HWIO_WCSS_A_AGC_RTT_OFFSET_80_ADDR A:0x6a013de8
y.create.l HWIO_WCSS_A_AGC_RTT_VALID_COUNT_ADDR A:0x6a013dec
y.create.l HWIO_WCSS_A_AGC_RTT_DELTA_MEAS_ADDR A:0x6a013df0
y.create.l HWIO_WCSS_A_AGC_RTT_REF_TIME_MEAS_LS16_ADDR A:0x6a013df4
y.create.l HWIO_WCSS_A_AGC_RTT_REF_TIME_MEAS_MS16_ADDR A:0x6a013df8
y.create.l HWIO_WCSS_A_AGC_RDET_RSSI_THRESHOLD_ADDR A:0x6a013dfc
y.create.l HWIO_WCSS_A_AGC_RDET_MIN_IAT_WRITE_ADDR A:0x6a013e00
y.create.l HWIO_WCSS_A_AGC_RDET_MAX_IAT_WRITE_ADDR A:0x6a013e04
y.create.l HWIO_WCSS_A_AGC_RDET_PULSE_WIDTH_MARGIN_WRITE_ADDR A:0x6a013e08
y.create.l HWIO_WCSS_A_AGC_RDET_MIN_PULSE_TRAIN_COUNT1_WRITE_ADDR A:0x6a013e0c
y.create.l HWIO_WCSS_A_AGC_RDET_MIN_PULSE_TRAIN_COUNT2_WRITE_ADDR A:0x6a013e10
y.create.l HWIO_WCSS_A_AGC_RDET_MIN_PULSE_TRAIN_COUNT3_WRITE_ADDR A:0x6a013e14
y.create.l HWIO_WCSS_A_AGC_RDET_MIN_PULSE_TRAIN_COUNT4_WRITE_ADDR A:0x6a013e18
y.create.l HWIO_WCSS_A_AGC_RDET_MIN_RADAR_PULSE_WIDTH_WRITE_ADDR A:0x6a013e1c
y.create.l HWIO_WCSS_A_AGC_RDET_MAX_RADAR_PULSE_WIDTH_WRITE_ADDR A:0x6a013e20
y.create.l HWIO_WCSS_A_AGC_RDET_MIN_IAT_READ_ADDR A:0x6a013e24
y.create.l HWIO_WCSS_A_AGC_RDET_MAX_IAT_READ_ADDR A:0x6a013e28
y.create.l HWIO_WCSS_A_AGC_RDET_PULSE_WIDTH_MARGIN_READ_ADDR A:0x6a013e2c
y.create.l HWIO_WCSS_A_AGC_RDET_MIN_PULSE_TRAIN_COUNT1_READ_ADDR A:0x6a013e30
y.create.l HWIO_WCSS_A_AGC_RDET_MIN_PULSE_TRAIN_COUNT2_READ_ADDR A:0x6a013e34
y.create.l HWIO_WCSS_A_AGC_RDET_MIN_PULSE_TRAIN_COUNT3_READ_ADDR A:0x6a013e38
y.create.l HWIO_WCSS_A_AGC_RDET_MIN_PULSE_TRAIN_COUNT4_READ_ADDR A:0x6a013e3c
y.create.l HWIO_WCSS_A_AGC_RDET_MIN_RADAR_PULSE_WIDTH_READ_ADDR A:0x6a013e40
y.create.l HWIO_WCSS_A_AGC_RDET_MAX_RADAR_PULSE_WIDTH_READ_ADDR A:0x6a013e44
y.create.l HWIO_WCSS_A_AGC_RDET_RESET_ADDR A:0x6a013e48
y.create.l HWIO_WCSS_A_AGC_RDET_RADAR_DETECTED_ADDR A:0x6a013e4c
y.create.l HWIO_WCSS_A_AGC_RDET_PULSEWIDTH_ADDR A:0x6a013e50
y.create.l HWIO_WCSS_A_AGC_RDET_NUM_DETECTED_ADDR A:0x6a013e54
y.create.l HWIO_WCSS_A_AGC_RDET_MEASUREMENT_DELAY_ADDR A:0x6a013e58
y.create.l HWIO_WCSS_A_AGC_RDET_FLAG_RESET_ADDR A:0x6a013e5c
y.create.l HWIO_WCSS_A_AGC_RSSI_THRESHOLD_CLIPPED_ADDR A:0x6a013e60
y.create.l HWIO_WCSS_A_AGC_CW_PULSE_WIDTH_ADDR A:0x6a013e64
y.create.l HWIO_WCSS_A_AGC_CW_RADAR_ADDR A:0x6a013e68
y.create.l HWIO_WCSS_A_AGC_ACI_DETECT_TH_ADDR A:0x6a013e6c
y.create.l HWIO_WCSS_A_AGC_TRANSITION_COUNT_GLOBAL_EN_ADDR A:0x6a013e70
y.create.l HWIO_WCSS_A_AGC_TRANSITION_COUNT0_EN_ADDR A:0x6a013e74
y.create.l HWIO_WCSS_A_AGC_TRANSITION_COUNT1_EN_ADDR A:0x6a013e78
y.create.l HWIO_WCSS_A_AGC_TRANSITION_COUNT2_EN_ADDR A:0x6a013e7c
y.create.l HWIO_WCSS_A_AGC_TRANSITION_COUNT3_EN_ADDR A:0x6a013e80
y.create.l HWIO_WCSS_A_AGC_TRANSITION_COUNT4_EN_ADDR A:0x6a013e84
y.create.l HWIO_WCSS_A_AGC_TRANSITION_COUNT5_EN_ADDR A:0x6a013e88
y.create.l HWIO_WCSS_A_AGC_TRANSITION_COUNT6_EN_ADDR A:0x6a013e8c
y.create.l HWIO_WCSS_A_AGC_TRANSITION_COUNT7_EN_ADDR A:0x6a013e90
y.create.l HWIO_WCSS_A_AGC_TRANSITION_COUNT8_EN_ADDR A:0x6a013e94
y.create.l HWIO_WCSS_A_AGC_TRANSITION_COUNT9_EN_ADDR A:0x6a013e98
y.create.l HWIO_WCSS_A_AGC_TRANSITION_COUNT10_EN_ADDR A:0x6a013e9c
y.create.l HWIO_WCSS_A_AGC_TRANSITION_COUNT11_EN_ADDR A:0x6a013ea0
y.create.l HWIO_WCSS_A_AGC_TRANSITION_COUNT0_ADDR A:0x6a013ea4
y.create.l HWIO_WCSS_A_AGC_TRANSITION_COUNT1_ADDR A:0x6a013ea8
y.create.l HWIO_WCSS_A_AGC_TRANSITION_COUNT2_ADDR A:0x6a013eac
y.create.l HWIO_WCSS_A_AGC_TRANSITION_COUNT3_ADDR A:0x6a013eb0
y.create.l HWIO_WCSS_A_AGC_TRANSITION_COUNT4_ADDR A:0x6a013eb4
y.create.l HWIO_WCSS_A_AGC_TRANSITION_COUNT5_ADDR A:0x6a013eb8
y.create.l HWIO_WCSS_A_AGC_TRANSITION_COUNT6_ADDR A:0x6a013ebc
y.create.l HWIO_WCSS_A_AGC_TRANSITION_COUNT7_ADDR A:0x6a013ec0
y.create.l HWIO_WCSS_A_AGC_TRANSITION_COUNT8_ADDR A:0x6a013ec4
y.create.l HWIO_WCSS_A_AGC_TRANSITION_COUNT9_ADDR A:0x6a013ec8
y.create.l HWIO_WCSS_A_AGC_TRANSITION_COUNT10_ADDR A:0x6a013ecc
y.create.l HWIO_WCSS_A_AGC_TRANSITION_COUNT11_ADDR A:0x6a013ed0
y.create.l HWIO_WCSS_A_AGC_NOISE_HIST_CTRL_ADDR A:0x6a013ed4
y.create.l HWIO_WCSS_A_AGC_NOISE_HIST_BIN0_MSW_ADDR A:0x6a013ed8
y.create.l HWIO_WCSS_A_AGC_NOISE_HIST_BIN0_LSW_ADDR A:0x6a013edc
y.create.l HWIO_WCSS_A_AGC_NOISE_HIST_BIN1_MSW_ADDR A:0x6a013ee0
y.create.l HWIO_WCSS_A_AGC_NOISE_HIST_BIN1_LSW_ADDR A:0x6a013ee4
y.create.l HWIO_WCSS_A_AGC_NOISE_HIST_BIN2_MSW_ADDR A:0x6a013ee8
y.create.l HWIO_WCSS_A_AGC_NOISE_HIST_BIN2_LSW_ADDR A:0x6a013eec
y.create.l HWIO_WCSS_A_AGC_NOISE_HIST_BIN3_MSW_ADDR A:0x6a013ef0
y.create.l HWIO_WCSS_A_AGC_NOISE_HIST_BIN3_LSW_ADDR A:0x6a013ef4
y.create.l HWIO_WCSS_A_AGC_NOISE_HIST_BIN4_MSW_ADDR A:0x6a013ef8
y.create.l HWIO_WCSS_A_AGC_NOISE_HIST_BIN4_LSW_ADDR A:0x6a013efc
y.create.l HWIO_WCSS_A_AGC_NOISE_HIST_BIN5_MSW_ADDR A:0x6a013f00
y.create.l HWIO_WCSS_A_AGC_NOISE_HIST_BIN5_LSW_ADDR A:0x6a013f04
y.create.l HWIO_WCSS_A_AGC_NOISE_HIST_BIN6_MSW_ADDR A:0x6a013f08
y.create.l HWIO_WCSS_A_AGC_NOISE_HIST_BIN6_LSW_ADDR A:0x6a013f0c
y.create.l HWIO_WCSS_A_AGC_NOISE_HIST_BIN7_MSW_ADDR A:0x6a013f10
y.create.l HWIO_WCSS_A_AGC_NOISE_HIST_BIN7_LSW_ADDR A:0x6a013f14
y.create.l HWIO_WCSS_A_AGC_NOISE_HIST_BIN8_MSW_ADDR A:0x6a013f18
y.create.l HWIO_WCSS_A_AGC_NOISE_HIST_BIN8_LSW_ADDR A:0x6a013f1c
y.create.l HWIO_WCSS_A_AGC_NOISE_HIST_BIN9_MSW_ADDR A:0x6a013f20
y.create.l HWIO_WCSS_A_AGC_NOISE_HIST_BIN9_LSW_ADDR A:0x6a013f24
y.create.l HWIO_WCSS_A_AGC_NOISE_HIST_BIN10_MSW_ADDR A:0x6a013f28
y.create.l HWIO_WCSS_A_AGC_NOISE_HIST_BIN10_LSW_ADDR A:0x6a013f2c
y.create.l HWIO_WCSS_A_AGC_NOISE_HIST_BUSY_MSW_ADDR A:0x6a013f30
y.create.l HWIO_WCSS_A_AGC_NOISE_HIST_BUSY_LSW_ADDR A:0x6a013f34
y.create.l HWIO_WCSS_A_AGC_WATCHDOG_MASK_ADDR A:0x6a013f38
y.create.l HWIO_WCSS_A_AGC_TIMEOUT_STATE_ADDR A:0x6a013f3c
y.create.l HWIO_WCSS_A_AGC_AGC_WATCHDOG_TIMEOUT_WAIT_DCO_A20_ADDR A:0x6a013f40
y.create.l HWIO_WCSS_A_AGC_AGC_WATCHDOG_TIMEOUT_WAIT_DCO_A40_ADDR A:0x6a013f44
y.create.l HWIO_WCSS_A_AGC_AGC_WATCHDOG_TIMEOUT_WAIT_DCO_A80_ADDR A:0x6a013f48
y.create.l HWIO_WCSS_A_AGC_AGC_WATCHDOG_TIMEOUT_WAIT_DCO_B_ADDR A:0x6a013f4c
y.create.l HWIO_WCSS_A_AGC_AGC_WATCHDOG_TIMEOUT_WAIT_A_ADDR A:0x6a013f50
y.create.l HWIO_WCSS_A_AGC_AGC_WATCHDOG_TIMEOUT_RXA_HDR_ADDR A:0x6a013f54
y.create.l HWIO_WCSS_A_AGC_AGC_WATCHDOG_TIMEOUT_HT_STS_COARSE_ADDR A:0x6a013f58
y.create.l HWIO_WCSS_A_AGC_AGC_WATCHDOG_TIMEOUT_HT_STS_FINE_ADDR A:0x6a013f5c
y.create.l HWIO_WCSS_A_AGC_AGC_WATCHDOG_TIMEOUT_VHT_STS_COARSE_ADDR A:0x6a013f60
y.create.l HWIO_WCSS_A_AGC_AGC_WATCHDOG_TIMEOUT_VHT_STS_FINE_ADDR A:0x6a013f64
y.create.l HWIO_WCSS_A_AGC_AGC_WATCHDOG_TIMEOUT_RXA_DATA_ADDR A:0x6a013f68
y.create.l HWIO_WCSS_A_AGC_AGC_WATCHDOG_TIMEOUT_CAP_A_ADDR A:0x6a013f6c
y.create.l HWIO_WCSS_A_AGC_AGC_WATCHDOG_TIMEOUT_TF_EST_ADDR A:0x6a013f70
y.create.l HWIO_WCSS_A_AGC_AGC_WATCHDOG_TIMEOUT_WAIT_B_ADDR A:0x6a013f74
y.create.l HWIO_WCSS_A_AGC_AGC_WATCHDOG_TIMEOUT_RXB_HDR_ADDR A:0x6a013f78
y.create.l HWIO_WCSS_A_AGC_AGC_WATCHDOG_TIMEOUT_RXB_DATA_ADDR A:0x6a013f7c
y.create.l HWIO_WCSS_A_AGC_AGC_WATCHDOG_TIMEOUT_CAP_B_ADDR A:0x6a013f80
y.create.l HWIO_WCSS_A_AGC_AGC_WATCHDOG_TIMEOUT_WAIT_SIFS_ADDR A:0x6a013f84
y.create.l HWIO_WCSS_A_AGC_CCA0_WATCHDOG_TIMEOUT_ADDR A:0x6a013f88
y.create.l HWIO_WCSS_A_AGC_CCA1_WATCHDOG_TIMEOUT_ADDR A:0x6a013f8c
y.create.l HWIO_WCSS_A_AGC_CCA2_WATCHDOG_TIMEOUT_ADDR A:0x6a013f90
y.create.l HWIO_WCSS_A_AGC_CCA0_WATCHDOG_EXPIRE_COUNT_ADDR A:0x6a013f94
y.create.l HWIO_WCSS_A_AGC_CCA1_WATCHDOG_EXPIRE_COUNT_ADDR A:0x6a013f98
y.create.l HWIO_WCSS_A_AGC_CCA2_WATCHDOG_EXPIRE_COUNT_ADDR A:0x6a013f9c
y.create.l HWIO_WCSS_A_AGC_RXFIR_CONFIG_ADDR A:0x6a013fa0
y.create.l HWIO_WCSS_A_AGC_VHTSIGA_P_AID1_ADDR A:0x6a013fa4
y.create.l HWIO_WCSS_A_AGC_VHTSIGA_P_AID2_ADDR A:0x6a013fa8
y.create.l HWIO_WCSS_A_AGC_VHTSIGA_P_AID3_ADDR A:0x6a013fac
y.create.l HWIO_WCSS_A_AGC_VHTSIGA_P_AID4_ADDR A:0x6a013fb0
y.create.l HWIO_WCSS_A_AGC_VHTSIGA_P_AID5_ADDR A:0x6a013fb4
y.create.l HWIO_WCSS_A_AGC_VHTSIGA_BWENCODING_ADDR A:0x6a013fb8
y.create.l HWIO_WCSS_A_AGC_VHTSIGA_GID1_ADDR A:0x6a013fbc
y.create.l HWIO_WCSS_A_AGC_VHTSIGA_GID2_ADDR A:0x6a013fc0
y.create.l HWIO_WCSS_A_AGC_CCA_GI_DET_CFG_LGI_ADDR A:0x6a013fc4
y.create.l HWIO_WCSS_A_AGC_CCA_GI_DET_CFG_SGI_ADDR A:0x6a013fc8
y.create.l HWIO_WCSS_A_AGC_CCA_GI_DET_CFG1_ADDR A:0x6a013fcc
y.create.l HWIO_WCSS_A_BBANA_ADC_CTRL_ADDR A:0x6a014000
y.create.l HWIO_WCSS_A_BBANA_ADC_CLK_CTRL_ADDR A:0x6a014004
y.create.l HWIO_WCSS_A_BBANA_ADC_REF_CTRL_ADDR A:0x6a014008
y.create.l HWIO_WCSS_A_BBANA_ADC_CONV_ADJ_ADDR A:0x6a01400c
y.create.l HWIO_WCSS_A_BBANA_ADC_SPARE_ADDR A:0x6a014010
y.create.l HWIO_WCSS_A_BBANA_ADC_SPARE3_ADDR A:0x6a014014
y.create.l HWIO_WCSS_A_BBANA_DAC_CTRL_ADDR A:0x6a014018
y.create.l HWIO_WCSS_A_BBANA_DAC_BIAS_ADDR A:0x6a01401c
y.create.l HWIO_WCSS_A_BBANA_DEBUG_ADDR A:0x6a014020
y.create.l HWIO_WCSS_A_BBANA_DAC_CFG_ADDR A:0x6a014024
y.create.l HWIO_WCSS_A_BBANA_DAC_CAL_CTRL_ADDR A:0x6a014028
y.create.l HWIO_WCSS_A_BBANA_DAC_CAL_CFG_ADDR A:0x6a01402c
y.create.l HWIO_WCSS_A_BBANA_DAC_CAL_STATUS_ADDR A:0x6a014030
y.create.l HWIO_WCSS_A_BMU_CONTROL_ADDR A:0x6a080000
y.create.l HWIO_WCSS_A_BMU_ERR_INTR_STATUS_ADDR A:0x6a080004
y.create.l HWIO_WCSS_A_BMU_ERR_INTR_ENABLE_ADDR A:0x6a080008
y.create.l HWIO_WCSS_A_BMU_ERR_INT_ADDR_ADDR A:0x6a08000c
y.create.l HWIO_WCSS_A_BMU_ERR_INT_WDATA_ADDR A:0x6a080010
y.create.l HWIO_WCSS_A_BMU_BD_PDU_THRESHOLD0_ADDR A:0x6a080014
y.create.l HWIO_WCSS_A_BMU_BD_PDU_THRESHOLD1_ADDR A:0x6a080018
y.create.l HWIO_WCSS_A_BMU_BD_PDU_THRESHOLD2_ADDR A:0x6a08001c
y.create.l HWIO_WCSS_A_BMU_BD_PDU_THRESHOLD3_ADDR A:0x6a080020
y.create.l HWIO_WCSS_A_BMU_BD_PDU_THRESHOLD4_ADDR A:0x6a080024
y.create.l HWIO_WCSS_A_BMU_BD_PDU_THRESHOLD5_ADDR A:0x6a080028
y.create.l HWIO_WCSS_A_BMU_BD_PDU_THRESHOLD6_ADDR A:0x6a08002c
y.create.l HWIO_WCSS_A_BMU_BD_PDU_THRESHOLD7_ADDR A:0x6a080030
y.create.l HWIO_WCSS_A_BMU_BD_PDU_THRESHOLD8_ADDR A:0x6a080034
y.create.l HWIO_WCSS_A_BMU_BD_PDU_THRESHOLD9_ADDR A:0x6a080038
y.create.l HWIO_WCSS_A_BMU_BD_PDU_THRESHOLD10_ADDR A:0x6a08003c
y.create.l HWIO_WCSS_A_BMU_WQ_ENABLE_ADDR A:0x6a08006c
y.create.l HWIO_WCSS_A_BMU_DPU_WQ_ASSIGNMENT_ADDR A:0x6a080070
y.create.l HWIO_WCSS_A_BMU_TEST_CTRL_ADDR A:0x6a080074
y.create.l HWIO_WCSS_A_BMU_TEST_OUT_LOW_ADDR A:0x6a080078
y.create.l HWIO_WCSS_A_BMU_TEST_OUT_HIGH_ADDR A:0x6a08007c
y.create.l HWIO_WCSS_A_BMU_GAS_CONFIGURATION_ADDR A:0x6a080080
y.create.l HWIO_WCSS_A_BMU_AVAILABLE_BD_PDU_AFTER_RSV_ADDR A:0x6a080084
y.create.l HWIO_WCSS_A_BMU_CONTROL2_ADDR A:0x6a080088
y.create.l HWIO_WCSS_A_BMU_DISABLE_WQ_DA_ADDR A:0x6a08008c
y.create.l HWIO_WCSS_A_BMU_DISABLE_BD_PDU_AVAIL_ADDR A:0x6a080090
y.create.l HWIO_WCSS_A_BMU_LAST_FOUR_POP_TRACE_CONTROL_ADDR A:0x6a080094
y.create.l HWIO_WCSS_A_BMU_POP_CMD_TRACE_BD_INDEX0_ADDR A:0x6a080098
y.create.l HWIO_WCSS_A_BMU_POP_CMD_TRACE_BD_INDEX1_ADDR A:0x6a08009c
y.create.l HWIO_WCSS_A_BMU_POP_CMD_TRACE_BD_INDEX2_ADDR A:0x6a0800a0
y.create.l HWIO_WCSS_A_BMU_POP_CMD_TRACE_BD_INDEX3_ADDR A:0x6a0800a4
y.create.l HWIO_WCSS_A_BMU_BMU_INTERNAL_MEM_TRACE_ADDR_ADDR A:0x6a0800ac
y.create.l HWIO_WCSS_A_BMU_RELEASE_ERROR_DETAILS_ADDR A:0x6a0800b0
y.create.l HWIO_WCSS_A_BMU_RELEASE_ERROR_DETAILS_LOW_ADDR A:0x6a0800b4
y.create.l HWIO_WCSS_A_BMU_RELEASE_ERROR_DETAILS_HIGH_ADDR A:0x6a0800b8
y.create.l HWIO_WCSS_A_BMU_RELEASE_FIFO_ENTRIES_ADDR A:0x6a0800bc
y.create.l HWIO_WCSS_A_BMU_LAST_BD_PREFETCH_HEAD_ADDR A:0x6a0800c0
y.create.l HWIO_WCSS_A_BMU_BD_PREFETCH_HEAD_BD_LINK_ADDR A:0x6a0800c4
y.create.l HWIO_WCSS_A_BMU_BMU_PUSH_INTEGRITY_ERR_BD_INDEX_ADDR A:0x6a0800c8
y.create.l HWIO_WCSS_A_BMU_BMU_WATCHDOG_TIMEOUT_TIME_ADDR A:0x6a0800cc
y.create.l HWIO_WCSS_A_BMU_BMU_SM_STATES_ON_ERROR_LOW_ADDR A:0x6a0800d0
y.create.l HWIO_WCSS_A_BMU_BMU_SM_STATES_ON_ERROR_HIGH_ADDR A:0x6a0800d4
y.create.l HWIO_WCSS_A_BMU_BMU_PREFETCH_ERROR_DETAILS_ADDR A:0x6a0800d8
y.create.l HWIO_WCSS_A_BMU_CONTROL3_ADDR A:0x6a0800dc
y.create.l HWIO_WCSS_A_BMU_CONTROL4_ADDR A:0x6a0800e0
y.create.l HWIO_WCSS_A_BMU_DPU_RSV_STATUS_ADDR A:0x6a0800e4
y.create.l HWIO_WCSS_A_BMU_RECEIVE_DEBUG_CONTROL_ADDR A:0x6a0800e8
y.create.l HWIO_WCSS_A_BMU_BMU_SPARE_REG_ADDR A:0x6a0800ec
y.create.l HWIO_WCSS_A_BMU_BTQM_CONTROL1_ADDR A:0x6a0800f0
y.create.l HWIO_WCSS_A_BMU_BTQM_CONTROL2_ADDR A:0x6a0800f4
y.create.l HWIO_WCSS_A_BMU_BTQM_STATUS_ADDR A:0x6a0800f8
y.create.l HWIO_WCSS_A_BMU_BTQM_STA_ENABLE_DISABLE_CONTROL_ADDR A:0x6a0800fc
y.create.l HWIO_WCSS_A_BMU_TRANSMIT_QUEUE_ACCESS_CONTROL1_ADDR A:0x6a080100
y.create.l HWIO_WCSS_A_BMU_TRANSMIT_QUEUE_ACCESS_CONTROL2_ADDR A:0x6a080104
y.create.l HWIO_WCSS_A_BMU_TRANSMIT_QUEUE_ACCESS_CONTROL3_ADDR A:0x6a080108
y.create.l HWIO_WCSS_A_BMU_TRANSMIT_QUEUE_ACCESS_CONTROL4_ADDR A:0x6a08010c
y.create.l HWIO_WCSS_A_BMU_TRANSMIT_QUEUE_ACCESS_CONTROL5_ADDR A:0x6a080110
y.create.l HWIO_WCSS_A_BMU_TRANSMIT_QUEUE_ACCESS_CONTROL6_ADDR A:0x6a080114
y.create.l HWIO_WCSS_A_BMU_BD_INDEX_INFO_ACCESS_CONTROL1_ADDR A:0x6a080118
y.create.l HWIO_WCSS_A_BMU_BD_INDEX_INFO_ACCESS_CONTROL2_ADDR A:0x6a08011c
y.create.l HWIO_WCSS_A_BMU_BD_INDEX_INFO_ACCESS_CONTROL3_ADDR A:0x6a080120
y.create.l HWIO_WCSS_A_BMU_BD_INDEX_INFO_ACCESS_CONTROL4_ADDR A:0x6a080124
y.create.l HWIO_WCSS_A_BMU_BD_INDEX_INFO_ACCESS_CONTROL5_ADDR A:0x6a080128
y.create.l HWIO_WCSS_A_BMU_BD_INDEX_INFO_ACCESS_CONTROL6_ADDR A:0x6a08012c
y.create.l HWIO_WCSS_A_BMU_BD_INDEX_INFO_ACCESS_CONTROL7_ADDR A:0x6a080130
y.create.l HWIO_WCSS_A_BMU_BAR_AND_FRAME_DROP_CONTROL_ADDR A:0x6a080134
y.create.l HWIO_WCSS_A_BMU_TX_QUEUE_STAID_QUEUEID_CONFIG_ADDR A:0x6a080138
y.create.l HWIO_WCSS_A_BMU_ENHANCED_TRACING_CONTROL1_ADDR A:0x6a08013c
y.create.l HWIO_WCSS_A_BMU_BTQM_QUEUE_INFO_BASE_ADDR_ADDR A:0x6a080140
y.create.l HWIO_WCSS_A_BMU_QOS_QUEUEID_MAPPING1_ADDR A:0x6a080144
y.create.l HWIO_WCSS_A_BMU_QOS_QUEUEID_MAPPING2_ADDR A:0x6a080148
y.create.l HWIO_WCSS_A_BMU_QOS_QUEUEID_MAPPING3_ADDR A:0x6a08014c
y.create.l HWIO_WCSS_A_BMU_QUEUEID_BO_MAPPING1_ADDR A:0x6a080154
y.create.l HWIO_WCSS_A_BMU_QUEUEID_BO_MAPPING2_ADDR A:0x6a080158
y.create.l HWIO_WCSS_A_BMU_FAST_TRACE_READING_CONTROL_ADDR A:0x6a080160
y.create.l HWIO_WCSS_A_BMU_FAST_TRACE_READING_DATA0_ADDR A:0x6a080164
y.create.l HWIO_WCSS_A_BMU_FAST_TRACE_READING_DATA1_ADDR A:0x6a080168
y.create.l HWIO_WCSS_A_BMU_FAST_TRACE_READING_DATA2_ADDR A:0x6a08016c
y.create.l HWIO_WCSS_A_BMU_FAST_BD_LINK_SETUP_CONTROL_ADDR A:0x6a080170
y.create.l HWIO_WCSS_A_BMU_STA_CONFIG_STATUS1_ADDR A:0x6a080174
y.create.l HWIO_WCSS_A_BMU_STA_CONFIG_STATUS2_ADDR A:0x6a080178
y.create.l HWIO_WCSS_A_BMU_STA_CONFIG_STATUS3_ADDR A:0x6a08017c
y.create.l HWIO_WCSS_A_BMU_STA_CONFIG_STATUS4_ADDR A:0x6a080180
y.create.l HWIO_WCSS_A_BMU_BTQM_ERR_STATUS_ADDR A:0x6a080184
y.create.l HWIO_WCSS_A_BMU_BTQM_ERR_ENABLE_ADDR A:0x6a080188
y.create.l HWIO_WCSS_A_BMU_BTQM_ERR_STATE_ADDR A:0x6a08018c
y.create.l HWIO_WCSS_A_BMU_BTQM_ERR_STATE2_ADDR A:0x6a080190
y.create.l HWIO_WCSS_A_BMU_BTQM_TPE_INT_STATS_ADDR A:0x6a080194
y.create.l HWIO_WCSS_A_BMU_RETRY_LIMIT_DROP_CNT_ADDR A:0x6a0801b4
y.create.l HWIO_WCSS_A_BMU_TPE_DROP_CNT_ADDR A:0x6a0801b8
y.create.l HWIO_WCSS_A_BMU_BA_HANDLER_ACKED_DROP_CNT_ADDR A:0x6a0801bc
y.create.l HWIO_WCSS_A_BMU_BA_HANDLER_WINDOW_MOVED_DROP_CNT_ADDR A:0x6a0801c0
y.create.l HWIO_WCSS_A_BMU_GET_INFO_CNT_ADDR A:0x6a0801c4
y.create.l HWIO_WCSS_A_BMU_GET_BD_INDEX_CNT_ADDR A:0x6a0801c8
y.create.l HWIO_WCSS_A_BMU_PWR_SAVE_STA_CNT_ADDR A:0x6a0801cc
y.create.l HWIO_WCSS_A_BMU_BTQM_FRAME_CNT_ADDR A:0x6a0801d0
y.create.l HWIO_WCSS_A_BMU_BTQM_TIMEOUT_CHECK_CTRL_ADDR A:0x6a0801d4
y.create.l HWIO_WCSS_A_BMU_PWR_STATE_CHANGE_INT_CONTROL_ADDR A:0x6a0801d8
y.create.l HWIO_WCSS_A_BMU_BTQM_INTERRUPT_STATUS_ADDR A:0x6a0801dc
y.create.l HWIO_WCSS_A_BMU_BTQM_INTERRUPT_ENABLE_ADDR A:0x6a0801e0
y.create.l HWIO_WCSS_A_BMU_PWR_SAVE_DROP_CTRL_ADDR A:0x6a0801e4
y.create.l HWIO_WCSS_A_BMU_PWR_SAVE_DROP_INT_CONTROL_ADDR A:0x6a0801e8
y.create.l HWIO_WCSS_A_BMU_BMU_BACKUP_CONTROL_ADDR A:0x6a0801ec
y.create.l HWIO_WCSS_A_BMU_BMU_QUEUE_DELAY_ACCESS_CONTROL_ADDR A:0x6a0801f0
y.create.l HWIO_WCSS_A_BMU_QUEUE_TRANSMIT_DELAY_VALUE_ADDR A:0x6a0801f4
y.create.l HWIO_WCSS_A_BMU_DXE_RX_WQ_INDEX_ADDR A:0x6a0801f8
y.create.l HWIO_WCSS_A_BMU_BMU_SIF_DATA_LENGTH_ADDR A:0x6a0801fc
y.create.l HWIO_WCSS_A_BMU_SW_BMU_DXE_DATA_LENGTH_ADDR A:0x6a080200
y.create.l HWIO_WCSS_A_BMU_BTQM_PACKET_MEMORY_UNIT_SIZE_ADDR A:0x6a080208
y.create.l HWIO_WCSS_A_BMU_SW_ACCESS_DEBUG_STATUS_ADDR A:0x6a08020c
y.create.l HWIO_WCSS_A_BMU_BTQM_TX_THRESHOLD_ADDR A:0x6a080210
y.create.l HWIO_WCSS_A_BMU_BTQM_STAID_3_TO_0_MEM_STATUS_ADDR A:0x6a080214
y.create.l HWIO_WCSS_A_BMU_BTQM_STAID_7_TO_4_MEM_STATUS_ADDR A:0x6a080218
y.create.l HWIO_WCSS_A_BMU_BTQM_PKT_MEMORY_STATUS_ADDR A:0x6a08021c
y.create.l HWIO_WCSS_A_BMU_HP_RX_MEMORY_UPPER_LIMIT_ADDR A:0x6a080220
y.create.l HWIO_WCSS_A_BMU_LP_RX_MEMORY_UPPER_LIMIT_ADDR A:0x6a080224
y.create.l HWIO_WCSS_A_BMU_BTQM_STAID_1_TO_0_MEM_THRESHOLD_ADDR A:0x6a080228
y.create.l HWIO_WCSS_A_BMU_BTQM_STAID_3_TO_2_MEM_THRESHOLD_ADDR A:0x6a08022c
y.create.l HWIO_WCSS_A_BMU_BTQM_STAID_5_TO_4_MEM_THRESHOLD_ADDR A:0x6a080230
y.create.l HWIO_WCSS_A_BMU_BTQM_STAID_7_TO_6_MEM_THRESHOLD_ADDR A:0x6a080234
y.create.l HWIO_WCSS_A_BMU_BTQM_STAID_15_TO_0_MEM_USAGE_STATUS_ADDR A:0x6a080238
y.create.l HWIO_WCSS_A_BMU_POLL_STATUS_TIMER_THRESHOLD_ADDR A:0x6a08023c
y.create.l HWIO_WCSS_A_BMU_BMU_IDLE_BD_PDU_STATUS_ADDR A:0x6a080240
y.create.l HWIO_WCSS_A_BMU_BTQM_STAID_11_TO_8_MEM_STATUS_ADDR A:0x6a080244
y.create.l HWIO_WCSS_A_BMU_BTQM_STAID_15_TO_12_MEM_STATUS_ADDR A:0x6a080248
y.create.l HWIO_WCSS_A_BMU_BTQM_STAID_9_TO_8_MEM_THRESHOLD_ADDR A:0x6a08024c
y.create.l HWIO_WCSS_A_BMU_BTQM_STAID_11_TO_10_MEM_THRESHOLD_ADDR A:0x6a080250
y.create.l HWIO_WCSS_A_BMU_BTQM_STAID_13_TO_12_MEM_THRESHOLD_ADDR A:0x6a080254
y.create.l HWIO_WCSS_A_BMU_BTQM_STAID_15_TO_14_MEM_THRESHOLD_ADDR A:0x6a080258
y.create.l HWIO_WCSS_A_BMU_BMU_PKT_MEMORY_CONFIG_MODE_ADDR A:0x6a08025c
y.create.l HWIO_WCSS_A_BMU_AVAILABLE_BD_PDU_AFTER_RSV_IN_LOCAL_MEM_ADDR A:0x6a080260
y.create.l HWIO_WCSS_A_BMU_BLOCK_DPU_RX_THRESHOLD_ADDR A:0x6a080264
y.create.l HWIO_WCSS_A_BMU_ADU_RX_LOW_THRESHOLD_ADDR A:0x6a080268
y.create.l HWIO_WCSS_A_BMU_DXE_TX_LOW_THRESHOLD_ADDR A:0x6a08026c
y.create.l HWIO_WCSS_A_BMU_DXE_RX_DA_SELECTION_ADDR A:0x6a080270
y.create.l HWIO_WCSS_A_BTCF_BTCF_CONFIG_ADDR A:0x6a014800
y.create.l HWIO_WCSS_A_BTCF_BTCF_DET_RATIO_ADDR A:0x6a014804
y.create.l HWIO_WCSS_A_BTCF_BTCF_DET_DSHIFT_ADDR A:0x6a014808
y.create.l HWIO_WCSS_A_BTCF_BTCFMIN_ADDR A:0x6a01480c
y.create.l HWIO_WCSS_A_BTCF_PWRMIN_ADDR A:0x6a014810
y.create.l HWIO_WCSS_A_BTCF_OFFSETMIN_ADDR A:0x6a014814
y.create.l HWIO_WCSS_A_CAHB_CAHB_RXP_PL_ADDR A:0x6a082c00
y.create.l HWIO_WCSS_A_CAHB_CAHB_TPE_PL_ADDR A:0x6a082c04
y.create.l HWIO_WCSS_A_CAHB_CAHB_RPE_PL_ADDR A:0x6a082c08
y.create.l HWIO_WCSS_A_CAHB_CAHB_RPEM_PL_ADDR A:0x6a082c0c
y.create.l HWIO_WCSS_A_CAHB_CAHB_DPU_PL_ADDR A:0x6a082c10
y.create.l HWIO_WCSS_A_CAHB_CAHB_ADU_PL_ADDR A:0x6a082c14
y.create.l HWIO_WCSS_A_CAHB_CAHB_CBR_PL_ADDR A:0x6a082c18
y.create.l HWIO_WCSS_A_CAHB_CAHB_CSU_PL_ADDR A:0x6a082c1c
y.create.l HWIO_WCSS_A_CAHB_CAHB_DFLT_MST_ADDR A:0x6a082c48
y.create.l HWIO_WCSS_A_CAHB_CAHB_VERSION_ADDR A:0x6a082c90
y.create.l HWIO_WCSS_A_CAL_CALMODE_ADDR A:0x6a008000
y.create.l HWIO_WCSS_A_CAL_MEASURE_ADDR A:0x6a008004
y.create.l HWIO_WCSS_A_CAL_CHAIN_SEL_ADDR A:0x6a008008
y.create.l HWIO_WCSS_A_CAL_LENGTH_INIT_ADDR A:0x6a00800c
y.create.l HWIO_WCSS_A_CAL_LENGTH_RSA_ADDR A:0x6a008010
y.create.l HWIO_WCSS_A_CAL_LENGTH_RSB_ADDR A:0x6a008014
y.create.l HWIO_WCSS_A_CAL_PIE_FFT_ADDR A:0x6a008018
y.create.l HWIO_WCSS_A_CAL_DCO_THRESHOLD_ADDR A:0x6a00801c
y.create.l HWIO_WCSS_A_CAL_DCTIMER1_ADDR A:0x6a008020
y.create.l HWIO_WCSS_A_CAL_DCTIMER2_ADDR A:0x6a008024
y.create.l HWIO_WCSS_A_CAL_DCOFFSET_ADDR A:0x6a008028
y.create.l HWIO_WCSS_A_CAL_PWRDCOFFSET_ADDR A:0x6a00802c
y.create.l HWIO_WCSS_A_CAL_CLR_DCOFFSET_ADDR A:0x6a008030
y.create.l HWIO_WCSS_A_CAL_CHN0_DCO_OVR_ADDR A:0x6a008034
y.create.l HWIO_WCSS_A_CAL_STATUS_ADDR A:0x6a008038
y.create.l HWIO_WCSS_A_CAL_OVERRIDE_ADDR A:0x6a00803c
y.create.l HWIO_WCSS_A_CAL_CORR_ENABLE_ADDR A:0x6a008040
y.create.l HWIO_WCSS_A_CAL_AIEST_ADDR A:0x6a008044
y.create.l HWIO_WCSS_A_CAL_IQ_CORR_MODE_ADDR A:0x6a008048
y.create.l HWIO_WCSS_A_CAL_DEBUG_OUTPUT_EN_MASK_ADDR A:0x6a00804c
y.create.l HWIO_WCSS_A_CAL_FORCE_TR_SWITCH_ADDR A:0x6a008050
y.create.l HWIO_WCSS_A_CAL_AIEST_DISABLE_ADDR A:0x6a008054
y.create.l HWIO_WCSS_A_CAL_BARAM_ACCESS_ADDR A:0x6a008058
y.create.l HWIO_WCSS_A_CAL_BARAM0_0_ADDR A:0x6a008800
y.create.l HWIO_WCSS_A_CAL_BARAM1_0_ADDR A:0x6a008808
y.create.l HWIO_WCSS_A_CAL_BARAM2_0_ADDR A:0x6a008810
y.create.l HWIO_WCSS_A_CAL_BARAM3_0_ADDR A:0x6a008818
y.create.l HWIO_WCSS_A_CAL_BARAM4_0_ADDR A:0x6a008820
y.create.l HWIO_WCSS_A_CAL_BARAM5_0_ADDR A:0x6a008828
y.create.l HWIO_WCSS_A_CAL_BARAM6_0_ADDR A:0x6a008830
y.create.l HWIO_WCSS_A_CAL_BARAM7_0_ADDR A:0x6a008838
y.create.l HWIO_WCSS_A_CAL_BARAM8_0_ADDR A:0x6a008840
y.create.l HWIO_WCSS_A_CAL_BARAM9_0_ADDR A:0x6a008848
y.create.l HWIO_WCSS_A_CAL_BARAM0_1_ADDR A:0x6a008804
y.create.l HWIO_WCSS_A_CAL_BARAM1_1_ADDR A:0x6a00880c
y.create.l HWIO_WCSS_A_CAL_BARAM2_1_ADDR A:0x6a008814
y.create.l HWIO_WCSS_A_CAL_BARAM3_1_ADDR A:0x6a00881c
y.create.l HWIO_WCSS_A_CAL_BARAM4_1_ADDR A:0x6a008824
y.create.l HWIO_WCSS_A_CAL_BARAM5_1_ADDR A:0x6a00882c
y.create.l HWIO_WCSS_A_CAL_BARAM6_1_ADDR A:0x6a008834
y.create.l HWIO_WCSS_A_CAL_BARAM7_1_ADDR A:0x6a00883c
y.create.l HWIO_WCSS_A_CAL_BARAM8_1_ADDR A:0x6a008844
y.create.l HWIO_WCSS_A_CAL_BARAM9_1_ADDR A:0x6a00884c
y.create.l HWIO_WCSS_A_CAL_IQ_CORR_COEFF_MEM0_0_ADDR A:0x6a009000
y.create.l HWIO_WCSS_A_CAL_IQ_CORR_COEFF_MEM1_0_ADDR A:0x6a009020
y.create.l HWIO_WCSS_A_CAL_IQ_CORR_COEFF_MEM2_0_ADDR A:0x6a009040
y.create.l HWIO_WCSS_A_CAL_IQ_CORR_COEFF_MEM3_0_ADDR A:0x6a009060
y.create.l HWIO_WCSS_A_CAL_IQ_CORR_COEFF_MEM4_0_ADDR A:0x6a009080
y.create.l HWIO_WCSS_A_CAL_IQ_CORR_COEFF_MEM5_0_ADDR A:0x6a0090a0
y.create.l HWIO_WCSS_A_CAL_IQ_CORR_COEFF_MEM6_0_ADDR A:0x6a0090c0
y.create.l HWIO_WCSS_A_CAL_IQ_CORR_COEFF_MEM7_0_ADDR A:0x6a0090e0
y.create.l HWIO_WCSS_A_CAL_IQ_CORR_COEFF_MEM8_0_ADDR A:0x6a009100
y.create.l HWIO_WCSS_A_CAL_IQ_CORR_COEFF_MEM9_0_ADDR A:0x6a009120
y.create.l HWIO_WCSS_A_CAL_IQ_CORR_COEFF_MEM0_1_ADDR A:0x6a009004
y.create.l HWIO_WCSS_A_CAL_IQ_CORR_COEFF_MEM1_1_ADDR A:0x6a009024
y.create.l HWIO_WCSS_A_CAL_IQ_CORR_COEFF_MEM2_1_ADDR A:0x6a009044
y.create.l HWIO_WCSS_A_CAL_IQ_CORR_COEFF_MEM3_1_ADDR A:0x6a009064
y.create.l HWIO_WCSS_A_CAL_IQ_CORR_COEFF_MEM4_1_ADDR A:0x6a009084
y.create.l HWIO_WCSS_A_CAL_IQ_CORR_COEFF_MEM5_1_ADDR A:0x6a0090a4
y.create.l HWIO_WCSS_A_CAL_IQ_CORR_COEFF_MEM6_1_ADDR A:0x6a0090c4
y.create.l HWIO_WCSS_A_CAL_IQ_CORR_COEFF_MEM7_1_ADDR A:0x6a0090e4
y.create.l HWIO_WCSS_A_CAL_IQ_CORR_COEFF_MEM8_1_ADDR A:0x6a009104
y.create.l HWIO_WCSS_A_CAL_IQ_CORR_COEFF_MEM9_1_ADDR A:0x6a009124
y.create.l HWIO_WCSS_A_CAL_IQ_CORR_COEFF_MEM0_2_ADDR A:0x6a009008
y.create.l HWIO_WCSS_A_CAL_IQ_CORR_COEFF_MEM1_2_ADDR A:0x6a009028
y.create.l HWIO_WCSS_A_CAL_IQ_CORR_COEFF_MEM2_2_ADDR A:0x6a009048
y.create.l HWIO_WCSS_A_CAL_IQ_CORR_COEFF_MEM3_2_ADDR A:0x6a009068
y.create.l HWIO_WCSS_A_CAL_IQ_CORR_COEFF_MEM4_2_ADDR A:0x6a009088
y.create.l HWIO_WCSS_A_CAL_IQ_CORR_COEFF_MEM5_2_ADDR A:0x6a0090a8
y.create.l HWIO_WCSS_A_CAL_IQ_CORR_COEFF_MEM6_2_ADDR A:0x6a0090c8
y.create.l HWIO_WCSS_A_CAL_IQ_CORR_COEFF_MEM7_2_ADDR A:0x6a0090e8
y.create.l HWIO_WCSS_A_CAL_IQ_CORR_COEFF_MEM8_2_ADDR A:0x6a009108
y.create.l HWIO_WCSS_A_CAL_IQ_CORR_COEFF_MEM9_2_ADDR A:0x6a009128
y.create.l HWIO_WCSS_A_CAL_IQ_CORR_COEFF_MEM0_3_ADDR A:0x6a00900c
y.create.l HWIO_WCSS_A_CAL_IQ_CORR_COEFF_MEM1_3_ADDR A:0x6a00902c
y.create.l HWIO_WCSS_A_CAL_IQ_CORR_COEFF_MEM2_3_ADDR A:0x6a00904c
y.create.l HWIO_WCSS_A_CAL_IQ_CORR_COEFF_MEM3_3_ADDR A:0x6a00906c
y.create.l HWIO_WCSS_A_CAL_IQ_CORR_COEFF_MEM4_3_ADDR A:0x6a00908c
y.create.l HWIO_WCSS_A_CAL_IQ_CORR_COEFF_MEM5_3_ADDR A:0x6a0090ac
y.create.l HWIO_WCSS_A_CAL_IQ_CORR_COEFF_MEM6_3_ADDR A:0x6a0090cc
y.create.l HWIO_WCSS_A_CAL_IQ_CORR_COEFF_MEM7_3_ADDR A:0x6a0090ec
y.create.l HWIO_WCSS_A_CAL_IQ_CORR_COEFF_MEM8_3_ADDR A:0x6a00910c
y.create.l HWIO_WCSS_A_CAL_IQ_CORR_COEFF_MEM9_3_ADDR A:0x6a00912c
y.create.l HWIO_WCSS_A_CAL_IQ_CORR_COEFF_MEM0_4_ADDR A:0x6a009010
y.create.l HWIO_WCSS_A_CAL_IQ_CORR_COEFF_MEM1_4_ADDR A:0x6a009030
y.create.l HWIO_WCSS_A_CAL_IQ_CORR_COEFF_MEM2_4_ADDR A:0x6a009050
y.create.l HWIO_WCSS_A_CAL_IQ_CORR_COEFF_MEM3_4_ADDR A:0x6a009070
y.create.l HWIO_WCSS_A_CAL_IQ_CORR_COEFF_MEM4_4_ADDR A:0x6a009090
y.create.l HWIO_WCSS_A_CAL_IQ_CORR_COEFF_MEM5_4_ADDR A:0x6a0090b0
y.create.l HWIO_WCSS_A_CAL_IQ_CORR_COEFF_MEM6_4_ADDR A:0x6a0090d0
y.create.l HWIO_WCSS_A_CAL_IQ_CORR_COEFF_MEM7_4_ADDR A:0x6a0090f0
y.create.l HWIO_WCSS_A_CAL_IQ_CORR_COEFF_MEM8_4_ADDR A:0x6a009110
y.create.l HWIO_WCSS_A_CAL_IQ_CORR_COEFF_MEM9_4_ADDR A:0x6a009130
y.create.l HWIO_WCSS_A_CAL_IQ_CORR_COEFF_MEM0_5_ADDR A:0x6a009014
y.create.l HWIO_WCSS_A_CAL_IQ_CORR_COEFF_MEM1_5_ADDR A:0x6a009034
y.create.l HWIO_WCSS_A_CAL_IQ_CORR_COEFF_MEM2_5_ADDR A:0x6a009054
y.create.l HWIO_WCSS_A_CAL_IQ_CORR_COEFF_MEM3_5_ADDR A:0x6a009074
y.create.l HWIO_WCSS_A_CAL_IQ_CORR_COEFF_MEM4_5_ADDR A:0x6a009094
y.create.l HWIO_WCSS_A_CAL_IQ_CORR_COEFF_MEM5_5_ADDR A:0x6a0090b4
y.create.l HWIO_WCSS_A_CAL_IQ_CORR_COEFF_MEM6_5_ADDR A:0x6a0090d4
y.create.l HWIO_WCSS_A_CAL_IQ_CORR_COEFF_MEM7_5_ADDR A:0x6a0090f4
y.create.l HWIO_WCSS_A_CAL_IQ_CORR_COEFF_MEM8_5_ADDR A:0x6a009114
y.create.l HWIO_WCSS_A_CAL_IQ_CORR_COEFF_MEM9_5_ADDR A:0x6a009134
y.create.l HWIO_WCSS_A_CCU_CCU_ENABLE_CLK_ADDR A:0x6a204000
y.create.l HWIO_WCSS_A_CCU_CCU_DISABLE_CLK_GATING_ADDR A:0x6a204004
y.create.l HWIO_WCSS_A_CCU_CCU_GCU_DISABLE_CLK_GATING_ADDR A:0x6a204008
y.create.l HWIO_WCSS_A_CCU_CCU_CRCM_CONTROL_ADDR A:0x6a20400c
y.create.l HWIO_WCSS_A_CCU_CCU_SOFT_RESET_ADDR A:0x6a204010
y.create.l HWIO_WCSS_A_CCU_CCU_SPARE_TEST_CTL_ADDR A:0x6a2050f4
y.create.l HWIO_WCSS_A_CCU_CCU_SPARE_INT_CTL_ADDR A:0x6a2050f8
y.create.l HWIO_WCSS_A_CCU_CCU_ROM_BASE_ADDR1_ADDR A:0x6a205000
y.create.l HWIO_WCSS_A_CCU_CCU_ROM_BASE_ADDR2_ADDR A:0x6a205004
y.create.l HWIO_WCSS_A_CCU_CCU_ROM_START_ADDR1_ADDR A:0x6a205008
y.create.l HWIO_WCSS_A_CCU_CCU_ROM_START_ADDR2_ADDR A:0x6a20500c
y.create.l HWIO_WCSS_A_CCU_CCU_ROM_START_ADDR3_ADDR A:0x6a205010
y.create.l HWIO_WCSS_A_CCU_CCU_ROM_START_ADDR4_ADDR A:0x6a205014
y.create.l HWIO_WCSS_A_CCU_CCU_ROM_END_ADDR1_ADDR A:0x6a205018
y.create.l HWIO_WCSS_A_CCU_CCU_ROM_END_ADDR2_ADDR A:0x6a20501c
y.create.l HWIO_WCSS_A_CCU_CCU_ROM_END_ADDR3_ADDR A:0x6a205020
y.create.l HWIO_WCSS_A_CCU_CCU_ROM_END_ADDR4_ADDR A:0x6a205024
y.create.l HWIO_WCSS_A_CCU_CCU_TESTBUS_CONTROL_ADDR A:0x6a20502c
y.create.l HWIO_WCSS_A_CCU_CCU_TESTBUS_LOWER_ADDR A:0x6a205030
y.create.l HWIO_WCSS_A_CCU_CCU_TESTBUS_UPPER_ADDR A:0x6a205034
y.create.l HWIO_WCSS_A_CCU_CCU_RRI_SW_REG_REINIT_ADDR A:0x6a205038
y.create.l HWIO_WCSS_A_CCU_CCU_RRI_SW_REG_REINIT_ADDR_ADDR A:0x6a20503c
y.create.l HWIO_WCSS_A_CCU_CCU_RRI_POLL_CMD_ERR_ADDR_ADDR A:0x6a205040
y.create.l HWIO_WCSS_A_CCU_CCU_RRI_MISC_CFG_ADDR A:0x6a205044
y.create.l HWIO_WCSS_A_CCU_CCU_MISC_CTL_ADDR A:0x6a20504c
y.create.l HWIO_WCSS_A_CCU_CCU_CCPU_STALL_COUNT_ADDR A:0x6a205050
y.create.l HWIO_WCSS_A_CCU_CCU_CCPU_ACTIVE_COUNT_ADDR A:0x6a205054
y.create.l HWIO_WCSS_A_CCU_CCU_CCPU_INVALID_ADDR_ADDR A:0x6a205058
y.create.l HWIO_WCSS_A_CCU_CCU_CCPU_LAST_ADDR0_ADDR A:0x6a20505c
y.create.l HWIO_WCSS_A_CCU_CCU_CCPU_LAST_ADDR1_ADDR A:0x6a205060
y.create.l HWIO_WCSS_A_CCU_CCU_CCPU_LAST_ADDR2_ADDR A:0x6a205064
y.create.l HWIO_WCSS_A_CCU_CCU_A2AB_ERR_ADDR_ADDR A:0x6a205068
y.create.l HWIO_WCSS_A_CCU_CCU_A2AB_CTL_ADDR A:0x6a20506c
y.create.l HWIO_WCSS_A_CCU_CCU_A2AB_CFG_ADDR A:0x6a205070
y.create.l HWIO_WCSS_A_CCU_CCU_WRAP_ADDR_ADDR A:0x6a205074
y.create.l HWIO_WCSS_A_CCU_CCU_AOWBR_ERR_ADDR_ADDR A:0x6a205078
y.create.l HWIO_WCSS_A_CCU_CCU_CCPU_TO_MSM_MB_INT_STAT_ADDR A:0x6a206000
y.create.l HWIO_WCSS_A_CCU_CCU_MSM_TO_CCPU_MB_INT_STAT_ADDR A:0x6a206004
y.create.l HWIO_WCSS_A_CCU_CCU_MB0_CONTROL_ADDR A:0x6a206008
y.create.l HWIO_WCSS_A_CCU_CCU_MB0_CONTROL_COUNTERS_ADDR A:0x6a20600c
y.create.l HWIO_WCSS_A_CCU_CCU_MB1_CONTROL_ADDR A:0x6a206010
y.create.l HWIO_WCSS_A_CCU_CCU_MB1_CONTROL_COUNTERS_ADDR A:0x6a206014
y.create.l HWIO_WCSS_A_CCU_CCU_MB2_CONTROL_ADDR A:0x6a206018
y.create.l HWIO_WCSS_A_CCU_CCU_MB2_CONTROL_COUNTERS_ADDR A:0x6a20601c
y.create.l HWIO_WCSS_A_CCU_CCU_MB3_CONTROL_ADDR A:0x6a206020
y.create.l HWIO_WCSS_A_CCU_CCU_MB3_CONTROL_COUNTERS_ADDR A:0x6a206024
y.create.l HWIO_WCSS_A_CCU_CCU_MB4_CONTROL_ADDR A:0x6a206028
y.create.l HWIO_WCSS_A_CCU_CCU_MB4_CONTROL_COUNTERS_ADDR A:0x6a20602c
y.create.l HWIO_WCSS_A_CCU_CCU_MB5_CONTROL_ADDR A:0x6a206030
y.create.l HWIO_WCSS_A_CCU_CCU_MB5_CONTROL_COUNTERS_ADDR A:0x6a206034
y.create.l HWIO_WCSS_A_CCU_CCU_MB6_CONTROL_ADDR A:0x6a206038
y.create.l HWIO_WCSS_A_CCU_CCU_MB6_CONTROL_COUNTERS_ADDR A:0x6a20603c
y.create.l HWIO_WCSS_A_CCU_CCU_MB7_CONTROL_ADDR A:0x6a206040
y.create.l HWIO_WCSS_A_CCU_CCU_MB7_CONTROL_COUNTERS_ADDR A:0x6a206044
y.create.l HWIO_WCSS_A_CCU_CCU_MUTEX0_ADDR A:0x6a2060b0
y.create.l HWIO_WCSS_A_CCU_CCU_MUTEX1_ADDR A:0x6a2060b4
y.create.l HWIO_WCSS_A_CCU_CCU_MUTEX2_ADDR A:0x6a2060b8
y.create.l HWIO_WCSS_A_CCU_CCU_MUTEX3_ADDR A:0x6a2060bc
y.create.l HWIO_WCSS_A_CCU_CCU_MUTEX4_ADDR A:0x6a2060c0
y.create.l HWIO_WCSS_A_CCU_CCU_MUTEX5_ADDR A:0x6a2060c4
y.create.l HWIO_WCSS_A_CCU_CCU_MUTEX6_ADDR A:0x6a2060c8
y.create.l HWIO_WCSS_A_CCU_CCU_MUTEX7_ADDR A:0x6a2060cc
y.create.l HWIO_WCSS_A_CCU_CCU_TRACE_CONTROL1_ADDR A:0x6a20507c
y.create.l HWIO_WCSS_A_CCU_CCU_TRACE_CONTROL2_ADDR A:0x6a205080
y.create.l HWIO_WCSS_A_CCU_CCU_TRC_WFT_CAPTURE_CTRL_ADDR A:0x6a205084
y.create.l HWIO_WCSS_A_CCU_CCU_TRC_WFT_STATE_CTRL_ADDR A:0x6a205088
y.create.l HWIO_WCSS_A_CCU_CCU_TRC_TS1_CAPTURE_CTRL_ADDR A:0x6a20508c
y.create.l HWIO_WCSS_A_CCU_CCU_TRC_TS1_STATE_CTRL_ADDR A:0x6a205090
y.create.l HWIO_WCSS_A_CCU_CCU_TRC_TS1_TRIGGER_MASK_ADDR A:0x6a205094
y.create.l HWIO_WCSS_A_CCU_CCU_TRC_TS1_TRIGGER_VALUE_ADDR A:0x6a205098
y.create.l HWIO_WCSS_A_CCU_CCU_TRC_TS2_CAPTURE_CTRL_ADDR A:0x6a20509c
y.create.l HWIO_WCSS_A_CCU_CCU_TRC_TS2_STATE_CTRL_ADDR A:0x6a2050a0
y.create.l HWIO_WCSS_A_CCU_CCU_TRC_TS2_TRIGGER_MASK_ADDR A:0x6a2050a4
y.create.l HWIO_WCSS_A_CCU_CCU_TRC_TS2_TRIGGER_VALUE_ADDR A:0x6a2050a8
y.create.l HWIO_WCSS_A_CCU_CCU_TRC_TS3_CAPTURE_CTRL_ADDR A:0x6a2050ac
y.create.l HWIO_WCSS_A_CCU_CCU_TRC_TS3_STATE_CTRL_ADDR A:0x6a2050b0
y.create.l HWIO_WCSS_A_CCU_CCU_TRC_TS3_TRIGGER_MASK_ADDR A:0x6a2050b4
y.create.l HWIO_WCSS_A_CCU_CCU_TRC_TS3_TRIGGER_VALUE_ADDR A:0x6a2050b8
y.create.l HWIO_WCSS_A_CCU_CCU_TRC_TS4_CAPTURE_CTRL_ADDR A:0x6a2050bc
y.create.l HWIO_WCSS_A_CCU_CCU_TRC_TS4_STATE_CTRL_ADDR A:0x6a2050c0
y.create.l HWIO_WCSS_A_CCU_CCU_TRC_TS4_TRIGGER_MASK_ADDR A:0x6a2050c4
y.create.l HWIO_WCSS_A_CCU_CCU_TRC_TS4_TRIGGER_VALUE_ADDR A:0x6a2050c8
y.create.l HWIO_WCSS_A_CCU_CCU_TRC_TS5_CAPTURE_CTRL_ADDR A:0x6a2050cc
y.create.l HWIO_WCSS_A_CCU_CCU_TRC_TS5_STATE_CTRL_ADDR A:0x6a2050d0
y.create.l HWIO_WCSS_A_CCU_CCU_TRC_TS5_TRIGGER_MASK_ADDR A:0x6a2050d4
y.create.l HWIO_WCSS_A_CCU_CCU_TRC_TS5_TRIGGER_VALUE_ADDR A:0x6a2050d8
y.create.l HWIO_WCSS_A_CCU_CCU_DXE_INT_SELECT_ADDR A:0x6a2050dc
y.create.l HWIO_WCSS_A_CCU_CCU_DXE_INT_SELECT_STATUS_ADDR A:0x6a2050e0
y.create.l HWIO_WCSS_A_CCU_CCU_ASIC_INT_ENABLE_ADDR A:0x6a2050e4
y.create.l HWIO_WCSS_A_CCU_CCU_ASIC_INT_STATUS_ADDR A:0x6a2050e8
y.create.l HWIO_WCSS_A_CCU_TESTMUX_CONTROL1_ADDR A:0x6a2050ec
y.create.l HWIO_WCSS_A_CCU_TESTMUX_CONTROL2_ADDR A:0x6a2050f0
y.create.l HWIO_WCSS_A_CCU_CCU_CCPU_DBG_STATUS_ADDR A:0x6a2050fc
y.create.l HWIO_WCSS_A_CCU_CCU_TRC_STATUS_ADDR A:0x6a205100
y.create.l HWIO_WCSS_A_CCU_CCU_TRC_TRIG_SAMPLE_ADDR A:0x6a205104
y.create.l HWIO_WCSS_A_CCU_CCU_TRC_RD_ADDR_ADDR A:0x6a205108
y.create.l HWIO_WCSS_A_CCU_SLP_CALIB_CYCLES_REG_ADDR A:0x6a20510c
y.create.l HWIO_WCSS_A_CCU_SLP_CALIB_CTL_REG_ADDR A:0x6a205110
y.create.l HWIO_WCSS_A_CCU_SLP_CALIB_DONE_REG_ADDR A:0x6a205114
y.create.l HWIO_WCSS_A_CCU_SLP_CALIB_CNT_AHB_PER_SLP_REG_ADDR A:0x6a205118
y.create.l HWIO_WCSS_A_CCU_AOWBR_TIMEOUT_ADDR_REG_ADDR A:0x6a20511c
y.create.l HWIO_WCSS_A_CCU_AOWBR_ERR_TIMEOUT_FLAGS_REG_ADDR A:0x6a205120
y.create.l HWIO_WCSS_A_CCU_UART_UART_RBR_ADDR A:0x6a207000
y.create.l HWIO_WCSS_A_CCU_UART_UART_DLH_ADDR A:0x6a207004
y.create.l HWIO_WCSS_A_CCU_UART_UART_IIR_ADDR A:0x6a207008
y.create.l HWIO_WCSS_A_CCU_UART_UART_LCR_ADDR A:0x6a20700c
y.create.l HWIO_WCSS_A_CCU_UART_UART_MCR_ADDR A:0x6a207010
y.create.l HWIO_WCSS_A_CCU_UART_UART_LSR_ADDR A:0x6a207014
y.create.l HWIO_WCSS_A_CCU_UART_UART_MSR_ADDR A:0x6a207018
y.create.l HWIO_WCSS_A_CCU_UART_UART_SCRATCH_ADDR A:0x6a20701c
y.create.l HWIO_WCSS_A_CCU_UART_UART_FAR_ADDR A:0x6a207070
y.create.l HWIO_WCSS_A_CCU_UART_UART_USR_ADDR A:0x6a20707c
y.create.l HWIO_WCSS_A_CCU_UART_UART_HTX_ADDR A:0x6a2070a4
y.create.l HWIO_WCSS_A_CCU_UART_UART_DMASA_ADDR A:0x6a2070a8
y.create.l HWIO_WCSS_A_CDAHB_CDAHB_RRI_PL_ADDR A:0x6a100000
y.create.l HWIO_WCSS_A_CDAHB_CDAHB_FDBR_PL_ADDR A:0x6a100004
y.create.l HWIO_WCSS_A_CDAHB_CDAHB_CCPU_PL_ADDR A:0x6a100008
y.create.l HWIO_WCSS_A_CDAHB_CDAHB_DBR_PL_ADDR A:0x6a10000c
y.create.l HWIO_WCSS_A_CDAHB_CDAHB_A2AB_PL_ADDR A:0x6a100010
y.create.l HWIO_WCSS_A_CDAHB_CDAHB_DXE_PL_ADDR A:0x6a100014
y.create.l HWIO_WCSS_A_CDAHB_CDAHB_DFLT_MST_ADDR A:0x6a100048
y.create.l HWIO_WCSS_A_CDAHB_CDAHB_VERSION_ADDR A:0x6a100090
y.create.l HWIO_WCSS_A_DAHB_DAHB_DPUW_PL_ADDR A:0x6a0c0000
y.create.l HWIO_WCSS_A_DAHB_DAHB_DPUR_PL_ADDR A:0x6a0c0004
y.create.l HWIO_WCSS_A_DAHB_DAHB_BMUW_PL_ADDR A:0x6a0c0008
y.create.l HWIO_WCSS_A_DAHB_DAHB_BMUR_PL_ADDR A:0x6a0c000c
y.create.l HWIO_WCSS_A_DAHB_DAHB_ADU_PL_ADDR A:0x6a0c0010
y.create.l HWIO_WCSS_A_DAHB_DAHB_CBR_PL_ADDR A:0x6a0c0014
y.create.l HWIO_WCSS_A_DAHB_DAHB_CSU_PL_ADDR A:0x6a0c0018
y.create.l HWIO_WCSS_A_DAHB_DAHB_DFLT_MST_ADDR A:0x6a0c0048
y.create.l HWIO_WCSS_A_DAHB_DAHB_VERSION_ADDR A:0x6a0c0090
y.create.l HWIO_WCSS_A_DPU_DPU_TXPKTCOUNT_ADDR A:0x6a081800
y.create.l HWIO_WCSS_A_DPU_DPU_RXPKTCOUNT_ADDR A:0x6a081804
y.create.l HWIO_WCSS_A_DPU_DPU_BASE_ADDR_ADDR A:0x6a08180c
y.create.l HWIO_WCSS_A_DPU_DPU_KEYBASE_ADDR_ADDR A:0x6a081810
y.create.l HWIO_WCSS_A_DPU_DPU_MICKEYBASE_ADDR_ADDR A:0x6a081814
y.create.l HWIO_WCSS_A_DPU_DPU_RCBASE_ADDR_ADDR A:0x6a081818
y.create.l HWIO_WCSS_A_DPU_DPU_CONTROL_ADDR A:0x6a08181c
y.create.l HWIO_WCSS_A_DPU_DPU_INTERRUPT_MASK_ADDR A:0x6a081820
y.create.l HWIO_WCSS_A_DPU_DPU_INTERRUPT_STATUS_ADDR A:0x6a081824
y.create.l HWIO_WCSS_A_DPU_DPU_BIP_MMIE_ADDR A:0x6a081828
y.create.l HWIO_WCSS_A_DPU_DPU_WATCHDOG_ADDR A:0x6a081848
y.create.l HWIO_WCSS_A_DPU_DPU_BD_IN_COUNTS_ADDR A:0x6a08184c
y.create.l HWIO_WCSS_A_DPU_DPU_BD_OUT_COUNTS_ADDR A:0x6a081850
y.create.l HWIO_WCSS_A_DPU_DPU_WQ_3_RESERVE_ADDR A:0x6a081854
y.create.l HWIO_WCSS_A_DPU_DPU_WQ_5_RESERVE_ADDR A:0x6a08185c
y.create.l HWIO_WCSS_A_DPU_DPU_WQ_6_RESERVE_ADDR A:0x6a081860
y.create.l HWIO_WCSS_A_DPU_DPU_WQ_7_RESERVE_ADDR A:0x6a081864
y.create.l HWIO_WCSS_A_DPU_DPU_ERROR_WQ_ADDR A:0x6a081874
y.create.l HWIO_WCSS_A_DPU_DPU_ERROR_WQ_SELECT_ADDR A:0x6a081878
y.create.l HWIO_WCSS_A_DPU_DPU_ERROR_WQ_COUNT_ADDR A:0x6a08187c
y.create.l HWIO_WCSS_A_DPU_DPU_FRAG_COUNT_ADDR A:0x6a081880
y.create.l HWIO_WCSS_A_DPU_DPU_DBG_TESTBUS_HI_ADDR A:0x6a081884
y.create.l HWIO_WCSS_A_DPU_DPU_DBG_TESTBUS_LO_ADDR A:0x6a081888
y.create.l HWIO_WCSS_A_DPU_DPU_DBG_WQ_AVAIL_ADDR A:0x6a08188c
y.create.l HWIO_WCSS_A_DPU_DPU_DBG_WQ_ALLOW_ADDR A:0x6a081890
y.create.l HWIO_WCSS_A_DPU_DPU_DBG_SM_STATE_ADDR A:0x6a081894
y.create.l HWIO_WCSS_A_DPU_DPU_DBG_BUF_FILL_ADDR A:0x6a081898
y.create.l HWIO_WCSS_A_DPU_DPU_DBG_BD_DPU_WORD0_ADDR A:0x6a08189c
y.create.l HWIO_WCSS_A_DPU_DPU_DBG_BD_DPU_WORD2_ADDR A:0x6a0818a0
y.create.l HWIO_WCSS_A_DPU_DPU_DBG_BD_DPU_WORD3_ADDR A:0x6a0818a4
y.create.l HWIO_WCSS_A_DPU_DPU_DBG_BD_DPU_WORD4_ADDR A:0x6a0818a8
y.create.l HWIO_WCSS_A_DPU_DPU_DBG_BD_DPU_WORD5_ADDR A:0x6a0818ac
y.create.l HWIO_WCSS_A_DPU_DPU_DBG_DD_WORD_0_ADDR A:0x6a0818d0
y.create.l HWIO_WCSS_A_DPU_DPU_DBG_DD_WORD_1_ADDR A:0x6a0818d4
y.create.l HWIO_WCSS_A_DPU_DPU_DBG_DD_WORD_2_ADDR A:0x6a0818d8
y.create.l HWIO_WCSS_A_DPU_DPU_DBG_DD_WORD_3_ADDR A:0x6a0818dc
y.create.l HWIO_WCSS_A_DPU_DPU_DBG_DD_WORD_4_ADDR A:0x6a0818e0
y.create.l HWIO_WCSS_A_DPU_DPU_WAPIMICKEYBASE_ADDR_ADDR A:0x6a0818e4
y.create.l HWIO_WCSS_A_DPU_DPU_BUG_FIX_ADDR A:0x6a0818e8
y.create.l HWIO_WCSS_A_DPU_DPU_AES_MASK_ADDR A:0x6a0818ec
y.create.l HWIO_WCSS_A_DPU_DPU_TKIP_MASK_ADDR A:0x6a0818f0
y.create.l HWIO_WCSS_A_DPU_DPU_SEQUENCE_NO_ADDR A:0x6a0818f4
y.create.l HWIO_WCSS_A_DPU_DPU_ROUTING_FLAG_ADDR A:0x6a0818f8
y.create.l HWIO_WCSS_A_DPU_DPU_HOST_WAKEUP_STATUS_MAGICBD_ADDR A:0x6a0818fc
y.create.l HWIO_WCSS_A_DPU_DPU_WOW_CONFIG_ADDR A:0x6a081900
y.create.l HWIO_WCSS_A_DPU_DPU_WOW_TIMERS_ADDR A:0x6a081904
y.create.l HWIO_WCSS_A_DPU_DPU_WOW_MAGIC_PACKET_HI_ADDR A:0x6a081908
y.create.l HWIO_WCSS_A_DPU_DPU_WOW_MAGIC_PACKET_LO_ADDR A:0x6a08190c
y.create.l HWIO_WCSS_A_DPU_WOW_FOUND_MAGIC_COUNTER_ADDR A:0x6a081910
y.create.l HWIO_WCSS_A_DPU_WOW_WAITING4MAGIC_COUNTER_ADDR A:0x6a081914
y.create.l HWIO_WCSS_A_DPU_WAPI_STA_KEY_INDEX_VALUES_ADDR A:0x6a081918
y.create.l HWIO_WCSS_A_DPU_WAPI_STA0_KEY_INDEXES_ADDR A:0x6a081920
y.create.l HWIO_WCSS_A_DPU_WAPI_STA1_KEY_INDEXES_ADDR A:0x6a081924
y.create.l HWIO_WCSS_A_DPU_WAPI_STA2_KEY_INDEXES_ADDR A:0x6a081928
y.create.l HWIO_WCSS_A_DPU_WAPI_STA3_KEY_INDEXES_ADDR A:0x6a08192c
y.create.l HWIO_WCSS_A_DPU_WAPI_STA4_KEY_INDEXES_ADDR A:0x6a081930
y.create.l HWIO_WCSS_A_DPU_WAPI_STA5_KEY_INDEXES_ADDR A:0x6a081934
y.create.l HWIO_WCSS_A_DPU_WAPI_STA6_KEY_INDEXES_ADDR A:0x6a081938
y.create.l HWIO_WCSS_A_DPU_WAPI_STA7_KEY_INDEXES_ADDR A:0x6a08193c
y.create.l HWIO_WCSS_A_DPU_WAPI_STA8_KEY_INDEXES_ADDR A:0x6a081940
y.create.l HWIO_WCSS_A_DPU_WAPI_STA9_KEY_INDEXES_ADDR A:0x6a081944
y.create.l HWIO_WCSS_A_DPU_WAPI_STA10_KEY_INDEXES_ADDR A:0x6a081948
y.create.l HWIO_WCSS_A_DPU_WAPI_STA11_KEY_INDEXES_ADDR A:0x6a08194c
y.create.l HWIO_WCSS_A_DPU_WAPI_STA12_KEY_INDEXES_ADDR A:0x6a081950
y.create.l HWIO_WCSS_A_DPU_WAPI_STA13_KEY_INDEXES_ADDR A:0x6a081954
y.create.l HWIO_WCSS_A_DPU_WAPI_STA14_KEY_INDEXES_ADDR A:0x6a081958
y.create.l HWIO_WCSS_A_DPU_WAPI_STA15_KEY_INDEXES_ADDR A:0x6a08195c
y.create.l HWIO_WCSS_A_DPU_WAPI_PN_CONFIG_ADDR A:0x6a081964
y.create.l HWIO_WCSS_A_FDAHB_FDAHB_RXP_PL_ADDR A:0x6a0c0400
y.create.l HWIO_WCSS_A_FDAHB_FDAHB_TXP_PL_ADDR A:0x6a0c0404
y.create.l HWIO_WCSS_A_FDAHB_FDAHB_TPE_PL_ADDR A:0x6a0c0408
y.create.l HWIO_WCSS_A_FDAHB_FDAHB_CBR_PL_ADDR A:0x6a0c040c
y.create.l HWIO_WCSS_A_FDAHB_FDAHB_RPE_PL_ADDR A:0x6a0c0410
y.create.l HWIO_WCSS_A_FDAHB_FDAHB_DFLT_MST_ADDR A:0x6a0c0448
y.create.l HWIO_WCSS_A_FDAHB_FDAHB_VERSION_ADDR A:0x6a0c0490
y.create.l HWIO_WCSS_A_FFT_FFT_RAM_00_0_ADDR A:0x6a00c000
y.create.l HWIO_WCSS_A_FFT_FFT_RAM_01_0_ADDR A:0x6a00c008
y.create.l HWIO_WCSS_A_FFT_FFT_RAM_02_0_ADDR A:0x6a00c010
y.create.l HWIO_WCSS_A_FFT_FFT_RAM_03_0_ADDR A:0x6a00c018
y.create.l HWIO_WCSS_A_FFT_FFT_RAM_04_0_ADDR A:0x6a00c020
y.create.l HWIO_WCSS_A_FFT_FFT_RAM_05_0_ADDR A:0x6a00c028
y.create.l HWIO_WCSS_A_FFT_FFT_RAM_06_0_ADDR A:0x6a00c030
y.create.l HWIO_WCSS_A_FFT_FFT_RAM_07_0_ADDR A:0x6a00c038
y.create.l HWIO_WCSS_A_FFT_FFT_RAM_08_0_ADDR A:0x6a00c040
y.create.l HWIO_WCSS_A_FFT_FFT_RAM_09_0_ADDR A:0x6a00c048
y.create.l HWIO_WCSS_A_FFT_FFT_RAM_00_1_ADDR A:0x6a00c004
y.create.l HWIO_WCSS_A_FFT_FFT_RAM_01_1_ADDR A:0x6a00c00c
y.create.l HWIO_WCSS_A_FFT_FFT_RAM_02_1_ADDR A:0x6a00c014
y.create.l HWIO_WCSS_A_FFT_FFT_RAM_03_1_ADDR A:0x6a00c01c
y.create.l HWIO_WCSS_A_FFT_FFT_RAM_04_1_ADDR A:0x6a00c024
y.create.l HWIO_WCSS_A_FFT_FFT_RAM_05_1_ADDR A:0x6a00c02c
y.create.l HWIO_WCSS_A_FFT_FFT_RAM_06_1_ADDR A:0x6a00c034
y.create.l HWIO_WCSS_A_FFT_FFT_RAM_07_1_ADDR A:0x6a00c03c
y.create.l HWIO_WCSS_A_FFT_FFT_RAM_08_1_ADDR A:0x6a00c044
y.create.l HWIO_WCSS_A_FFT_FFT_RAM_09_1_ADDR A:0x6a00c04c
y.create.l HWIO_WCSS_A_FFT_FFT_RAM_10_0_ADDR A:0x6a00c800
y.create.l HWIO_WCSS_A_FFT_FFT_RAM_11_0_ADDR A:0x6a00c808
y.create.l HWIO_WCSS_A_FFT_FFT_RAM_12_0_ADDR A:0x6a00c810
y.create.l HWIO_WCSS_A_FFT_FFT_RAM_13_0_ADDR A:0x6a00c818
y.create.l HWIO_WCSS_A_FFT_FFT_RAM_14_0_ADDR A:0x6a00c820
y.create.l HWIO_WCSS_A_FFT_FFT_RAM_15_0_ADDR A:0x6a00c828
y.create.l HWIO_WCSS_A_FFT_FFT_RAM_16_0_ADDR A:0x6a00c830
y.create.l HWIO_WCSS_A_FFT_FFT_RAM_17_0_ADDR A:0x6a00c838
y.create.l HWIO_WCSS_A_FFT_FFT_RAM_18_0_ADDR A:0x6a00c840
y.create.l HWIO_WCSS_A_FFT_FFT_RAM_19_0_ADDR A:0x6a00c848
y.create.l HWIO_WCSS_A_FFT_FFT_RAM_10_1_ADDR A:0x6a00c804
y.create.l HWIO_WCSS_A_FFT_FFT_RAM_11_1_ADDR A:0x6a00c80c
y.create.l HWIO_WCSS_A_FFT_FFT_RAM_12_1_ADDR A:0x6a00c814
y.create.l HWIO_WCSS_A_FFT_FFT_RAM_13_1_ADDR A:0x6a00c81c
y.create.l HWIO_WCSS_A_FFT_FFT_RAM_14_1_ADDR A:0x6a00c824
y.create.l HWIO_WCSS_A_FFT_FFT_RAM_15_1_ADDR A:0x6a00c82c
y.create.l HWIO_WCSS_A_FFT_FFT_RAM_16_1_ADDR A:0x6a00c834
y.create.l HWIO_WCSS_A_FFT_FFT_RAM_17_1_ADDR A:0x6a00c83c
y.create.l HWIO_WCSS_A_FFT_FFT_RAM_18_1_ADDR A:0x6a00c844
y.create.l HWIO_WCSS_A_FFT_FFT_RAM_19_1_ADDR A:0x6a00c84c
y.create.l HWIO_WCSS_A_FFT_APB_ACCESS_ADDR A:0x6a00d000
y.create.l HWIO_WCSS_A_FFT_FFT_TOGGLE_ADDR A:0x6a00d004
y.create.l HWIO_WCSS_A_MCU_BD_PDU_BASE_ADDR_ADDR A:0x6a080c00
y.create.l HWIO_WCSS_A_MCU_MLC_CONTROL_ADDR A:0x6a080c04
y.create.l HWIO_WCSS_A_MCU_DBR_STATUS_ADDR A:0x6a080c0c
y.create.l HWIO_WCSS_A_MCU_MCPU_TO_HOST_MB_INT_STAT_ADDR A:0x6a080c10
y.create.l HWIO_WCSS_A_MCU_HOST_TO_MCPU_MB_INT_STAT_ADDR A:0x6a080c14
y.create.l HWIO_WCSS_A_MCU_MB0_CONTROL_ADDR A:0x6a080c18
y.create.l HWIO_WCSS_A_MCU_MB0_CONTROL_COUNTERS_ADDR A:0x6a080c1c
y.create.l HWIO_WCSS_A_MCU_MB1_CONTROL_ADDR A:0x6a080c20
y.create.l HWIO_WCSS_A_MCU_MB1_CONTROL_COUNTERS_ADDR A:0x6a080c24
y.create.l HWIO_WCSS_A_MCU_MB2_CONTROL_ADDR A:0x6a080c28
y.create.l HWIO_WCSS_A_MCU_MB2_CONTROL_COUNTERS_ADDR A:0x6a080c2c
y.create.l HWIO_WCSS_A_MCU_MB3_CONTROL_ADDR A:0x6a080c30
y.create.l HWIO_WCSS_A_MCU_MB3_CONTROL_COUNTERS_ADDR A:0x6a080c34
y.create.l HWIO_WCSS_A_MCU_MUTEX0_ADDR A:0x6a080c98
y.create.l HWIO_WCSS_A_MCU_MUTEX1_ADDR A:0x6a080c9c
y.create.l HWIO_WCSS_A_MCU_MUTEX2_ADDR A:0x6a080ca0
y.create.l HWIO_WCSS_A_MCU_MUTEX3_ADDR A:0x6a080ca4
y.create.l HWIO_WCSS_A_MCU_SOFT_RESET_ADDR A:0x6a080cb8
y.create.l HWIO_WCSS_A_MCU_MAC_CLK_GATING_ENABLE_ADDR A:0x6a080cbc
y.create.l HWIO_WCSS_A_MCU_MAC_TESTBUS_CONTROL_ADDR A:0x6a080cc0
y.create.l HWIO_WCSS_A_MCU_MAC_FPGA_VERSION_ADDR A:0x6a080cc4
y.create.l HWIO_WCSS_A_MCU_MAC_MODULES_ROOT_CLK_ENABLES_ADDR A:0x6a080cd4
y.create.l HWIO_WCSS_A_MCU_MAC_MODULES_GOTO_IDLE_CONTROL_ADDR A:0x6a080cd8
y.create.l HWIO_WCSS_A_MCU_MAC_TESTBUS_LOW_ADDR A:0x6a080cdc
y.create.l HWIO_WCSS_A_MCU_MAC_TESTBUS_HIGH_ADDR A:0x6a080ce0
y.create.l HWIO_WCSS_A_MCU_APB2PHY_STATUS_ADDR A:0x6a080cec
y.create.l HWIO_WCSS_A_MCU_MLC_STATUS_ADDR A:0x6a080cf0
y.create.l HWIO_WCSS_A_MCU_RF_WARMUP_CONTROL_ADDR A:0x6a080d00
y.create.l HWIO_WCSS_A_MCU_BTC_ADDR A:0x6a080d04
y.create.l HWIO_WCSS_A_MCU_RF_ON_OFF_CONTROL_ADDR A:0x6a080d08
y.create.l HWIO_WCSS_A_MCU_DEBUGC_CONTROL_ADDR A:0x6a080d94
y.create.l HWIO_WCSS_A_MCU_DABH_MIF_PRIORITY_GENERATION_CONTROL_ADDR A:0x6a080e10
y.create.l HWIO_WCSS_A_MCU_BTC_CTRL_ADDR A:0x6a080e14
y.create.l HWIO_WCSS_A_MCU_BTC_CTRL2_ADDR A:0x6a080e18
y.create.l HWIO_WCSS_A_MCU_BTC_CTRL3_ADDR A:0x6a080e1c
y.create.l HWIO_WCSS_A_MCU_BTC_STATUS_ADDR A:0x6a080e20
y.create.l HWIO_WCSS_A_MCU_BTC_STATUS2_ADDR A:0x6a080e24
y.create.l HWIO_WCSS_A_MCU_BTC_FRAME1_STATUS_ADDR A:0x6a080e2c
y.create.l HWIO_WCSS_A_MCU_BTC_FRAME2_STATUS_ADDR A:0x6a080e30
y.create.l HWIO_WCSS_A_MCU_FIQ_EN_ADDR A:0x6a080e38
y.create.l HWIO_WCSS_A_MCU_FIQ_STATUS_ADDR A:0x6a080e3c
y.create.l HWIO_WCSS_A_MCU_FIQ_MASKED_STATUS_ADDR A:0x6a080e40
y.create.l HWIO_WCSS_A_MCU_FIQ_CLEAR_ADDR A:0x6a080e44
y.create.l HWIO_WCSS_A_MCU_IRQ_EN_ADDR A:0x6a080e48
y.create.l HWIO_WCSS_A_MCU_IRQ_STATUS_ADDR A:0x6a080e4c
y.create.l HWIO_WCSS_A_MCU_IRQ_MASKED_STATUS_ADDR A:0x6a080e50
y.create.l HWIO_WCSS_A_MCU_IRQ_CLEAR_ADDR A:0x6a080e54
y.create.l HWIO_WCSS_A_MCU_MTU_INT_EN_ADDR A:0x6a080e58
y.create.l HWIO_WCSS_A_MCU_MTU_INT_STATUS_ADDR A:0x6a080e5c
y.create.l HWIO_WCSS_A_MCU_MTU_INT_MASKED_STATUS_ADDR A:0x6a080e60
y.create.l HWIO_WCSS_A_MCU_MTU_INT_CLEAR_ADDR A:0x6a080e64
y.create.l HWIO_WCSS_A_MCU_COMBINED_INT_EN_ADDR A:0x6a080e68
y.create.l HWIO_WCSS_A_MCU_COMBINED_INT_STATUS_ADDR A:0x6a080e6c
y.create.l HWIO_WCSS_A_MCU_COMBINED_INT_MASKED_STATUS_ADDR A:0x6a080e70
y.create.l HWIO_WCSS_A_MCU_COMBINED_INT_CLEAR_ADDR A:0x6a080e74
y.create.l HWIO_WCSS_A_MCU_BMU_WQ_INT_EN_ADDR A:0x6a080e78
y.create.l HWIO_WCSS_A_MCU_BMU_WQ_INT_STATUS_ADDR A:0x6a080e7c
y.create.l HWIO_WCSS_A_MCU_BMU_WQ_INT_MASKED_STATUS_ADDR A:0x6a080e80
y.create.l HWIO_WCSS_A_MCU_BMU_WQ_INT_CLEAR_ADDR A:0x6a080e84
y.create.l HWIO_WCSS_A_MCU_SW_INT_0_ADDR A:0x6a080e98
y.create.l HWIO_WCSS_A_MCU_SW_INT_1_ADDR A:0x6a080e9c
y.create.l HWIO_WCSS_A_MCU_MCU_HOST_INT_EN_ADDR A:0x6a080ea0
y.create.l HWIO_WCSS_A_MCU_MCU_HOST_INT_STATUS_ADDR A:0x6a080ea4
y.create.l HWIO_WCSS_A_MCU_MCU_HOST_INT_MASKED_STATUS_ADDR A:0x6a080ea8
y.create.l HWIO_WCSS_A_MCU_MCU_HOST_INT_CLEAR_ADDR A:0x6a080eac
y.create.l HWIO_WCSS_A_MCU_MCU_PMU_INFO_ADDR A:0x6a080eb0
y.create.l HWIO_WCSS_A_MCU_MCU_WMAC_STATUS_ADDR A:0x6a080eb4
y.create.l HWIO_WCSS_A_MCU_MAC_HOST_INT_EN_ADDR A:0x6a080eb8
y.create.l HWIO_WCSS_A_MCU_MAC_HOST_INT_STATUS_ADDR A:0x6a080ebc
y.create.l HWIO_WCSS_A_MCU_MAC_HOST_INT_MASKED_STATUS_ADDR A:0x6a080ec0
y.create.l HWIO_WCSS_A_MCU_MAC_HOST_INT_CLEAR_ADDR A:0x6a080ec4
y.create.l HWIO_WCSS_A_MCU_MTU_HOST_INT_EN_ADDR A:0x6a080ec8
y.create.l HWIO_WCSS_A_MCU_MTU_HOST_INT_MASKED_STATUS_ADDR A:0x6a080ecc
y.create.l HWIO_WCSS_A_MCU_COMBINED_HOST_INT_EN_ADDR A:0x6a080ed0
y.create.l HWIO_WCSS_A_MCU_COMBINED_HOST_INT_MASKED_STATUS_ADDR A:0x6a080ed4
y.create.l HWIO_WCSS_A_MCU_BMU_WQ_HOST_INT_EN_ADDR A:0x6a080ed8
y.create.l HWIO_WCSS_A_MCU_BMU_WQ_HOST_INT_MASKED_STATUS_ADDR A:0x6a080edc
y.create.l HWIO_WCSS_A_MCU_MTU_TIMER_INTERRUPT_SOURCE_ADDR A:0x6a080ee0
y.create.l HWIO_WCSS_A_MCU_BTC_CTRL4_ADDR A:0x6a080f00
y.create.l HWIO_WCSS_A_MCU_BTC_PATTERN_DET1_ADDR A:0x6a080f04
y.create.l HWIO_WCSS_A_MCU_BTC_PATTERN_DET2_ADDR A:0x6a080f08
y.create.l HWIO_WCSS_A_MCU_BTC_PATTERN_HISTORY_ADDR A:0x6a080f0c
y.create.l HWIO_WCSS_A_MCU_BTC_HI_GRANT_ADDR A:0x6a080f10
y.create.l HWIO_WCSS_A_MCU_BTC_LOW_GRANT_ADDR A:0x6a080f14
y.create.l HWIO_WCSS_A_MCU_BTC_REQ_CNT_ADDR A:0x6a080f18
y.create.l HWIO_WCSS_A_MCU_MRCM_CLK_GATE_DISABLE_ADDR A:0x6a080f1c
y.create.l HWIO_WCSS_A_MCU_TXP_BUSY_CNT_ADDR A:0x6a080f20
y.create.l HWIO_WCSS_A_MCU_WLAN_BRIDGE_CTRL_ADDR A:0x6a080f24
y.create.l HWIO_WCSS_A_MCU_BD_PDU_BASE_ADDR_LOCAL_ADDR A:0x6a080f30
y.create.l HWIO_WCSS_A_MCU_CMEM_BDINDEX_THRESHOLD_ADDR A:0x6a080f34
y.create.l HWIO_WCSS_A_MCU_CSU_CONFIGURATION_ADDR A:0x6a080f38
y.create.l HWIO_WCSS_A_MCU_MCU_CSU_NEXTHDR_BITMAP_0_ADDR A:0x6a080f3c
y.create.l HWIO_WCSS_A_MCU_MCU_CSU_NEXTHDR_BITMAP_1_ADDR A:0x6a080f40
y.create.l HWIO_WCSS_A_MCU_MCU_CSU_NEXTHDR_BITMAP_2_ADDR A:0x6a080f44
y.create.l HWIO_WCSS_A_MCU_MCU_CSU_NEXTHDR_BITMAP_3_ADDR A:0x6a080f48
y.create.l HWIO_WCSS_A_MCU_MCU_CSU_NEXTHDR_BITMAP_4_ADDR A:0x6a080f4c
y.create.l HWIO_WCSS_A_MCU_MCU_CSU_NEXTHDR_BITMAP_5_ADDR A:0x6a080f50
y.create.l HWIO_WCSS_A_MCU_MCU_CSU_NEXTHDR_BITMAP_6_ADDR A:0x6a080f54
y.create.l HWIO_WCSS_A_MCU_MCU_CSU_NEXTHDR_BITMAP_7_ADDR A:0x6a080f58
y.create.l HWIO_WCSS_A_MCU_MCU_CSU_TX_WORK_QUEUES_ADDR A:0x6a080f5c
y.create.l HWIO_WCSS_A_MCU_MCU_CSU_TX_DEBUG_COUNTERS1_ADDR A:0x6a080f60
y.create.l HWIO_WCSS_A_MCU_MCU_CSU_TX_DEBUG_COUNTERS2_ADDR A:0x6a080f64
y.create.l HWIO_WCSS_A_MCU_MCU_CSU_TX_DEBUG_COUNTERS3_ADDR A:0x6a080f68
y.create.l HWIO_WCSS_A_MCU_MCU_CSU_RX_WORK_QUEUES_ADDR A:0x6a080f6c
y.create.l HWIO_WCSS_A_MCU_MCU_CSU_RX_DEBUG_COUNTERS1_ADDR A:0x6a080f70
y.create.l HWIO_WCSS_A_MCU_MCU_CSU_RX_DEBUG_COUNTERS2_ADDR A:0x6a080f74
y.create.l HWIO_WCSS_A_MCU_MCU_CSU_RX_DEBUG_COUNTERS3_ADDR A:0x6a080f78
y.create.l HWIO_WCSS_A_MCU_MCU_CSU_INTERRUPT_ADDR A:0x6a080f7c
y.create.l HWIO_WCSS_A_MCU_MCU_CBR_CCAHB_ERR_ADDR_ADDR A:0x6a080f80
y.create.l HWIO_WCSS_A_MCU_MCU_CBR_CAHB_ERR_ADDR_ADDR A:0x6a080f84
y.create.l HWIO_WCSS_A_MCU_MCU_CBR_CCAHB_TIMEOUT_ADDR_ADDR A:0x6a080f88
y.create.l HWIO_WCSS_A_MCU_MCU_CBR_CAHB_TIMEOUT_ADDR_ADDR A:0x6a080f8c
y.create.l HWIO_WCSS_A_MCU_MCU_DBR_CDAHB_ERR_ADDR_ADDR A:0x6a080f90
y.create.l HWIO_WCSS_A_MCU_MCU_DBR_DAHB_ERR_ADDR_ADDR A:0x6a080f94
y.create.l HWIO_WCSS_A_MCU_MCU_DBR_CDAHB_TIMEOUT_ADDR_ADDR A:0x6a080f98
y.create.l HWIO_WCSS_A_MCU_MCU_DBR_DAHB_TIMEOUT_ADDR_ADDR A:0x6a080f9c
y.create.l HWIO_WCSS_A_MCU_MCU_FDBR_CDAHB_ERR_ADDR_ADDR A:0x6a080fa0
y.create.l HWIO_WCSS_A_MCU_MCU_FDBR_FDAHB_ERR_ADDR_ADDR A:0x6a080fa4
y.create.l HWIO_WCSS_A_MCU_MCU_FDBR_CDAHB_TIMEOUT_ADDR_ADDR A:0x6a080fa8
y.create.l HWIO_WCSS_A_MCU_MCU_FDBR_FDAHB_TIMEOUT_ADDR_ADDR A:0x6a080fac
y.create.l HWIO_WCSS_A_MCU_MCU_WLAN_BRIDGE_ERR_TIMEOUT_SRC_ADDR A:0x6a080fb0
y.create.l HWIO_WCSS_A_MPI_WATCHDOG_MAX_COMMAND1_ADDR A:0x6a013400
y.create.l HWIO_WCSS_A_MPI_WATCHDOG_MAX_COMMAND2_ADDR A:0x6a013404
y.create.l HWIO_WCSS_A_MPI_WATCHDOG_MAX_WAIT_ADDR A:0x6a013408
y.create.l HWIO_WCSS_A_MPI_WATCHDOG_MAX_TRANSFER_ADDR A:0x6a01340c
y.create.l HWIO_WCSS_A_MPI_MAX_REQAORB_ADDR A:0x6a013410
y.create.l HWIO_WCSS_A_MPI_COMMAND2_DELAY_ADDR A:0x6a013414
y.create.l HWIO_WCSS_A_MPI_MPI_ENABLE_ADDR A:0x6a013418
y.create.l HWIO_WCSS_A_MPI_TXP_MPI_START_ADDR A:0x6a01341c
y.create.l HWIO_WCSS_A_MPI_MPI_TXP_REQ_ADDR A:0x6a013420
y.create.l HWIO_WCSS_A_MPI_TXA_MPI_DATA_REQ_ADDR A:0x6a013424
y.create.l HWIO_WCSS_A_MPI_TXB_MPI_DATA_REQ_ADDR A:0x6a013428
y.create.l HWIO_WCSS_A_MPI_TXP_MPI_DATA_VAL_ADDR A:0x6a01342c
y.create.l HWIO_WCSS_A_MPI_MPI_TXA_DATA_VAL_ADDR A:0x6a013430
y.create.l HWIO_WCSS_A_MPI_MPI_TXB_DATA_VAL_ADDR A:0x6a013434
y.create.l HWIO_WCSS_A_MPI_MPI_TXA_LASTBYTE_ADDR A:0x6a013438
y.create.l HWIO_WCSS_A_MPI_MPI_TXA_CW_LASTBYTE_ADDR A:0x6a01343c
y.create.l HWIO_WCSS_A_MPI_MPI_TXA_CW_MAX_PARITY_ADDR A:0x6a013440
y.create.l HWIO_WCSS_A_MPI_MPI_STATE_ADDR A:0x6a013444
y.create.l HWIO_WCSS_A_MPI_STATUS_FLAGS_ADDR A:0x6a013448
y.create.l HWIO_WCSS_A_MPI_REQ_ALARM_ADDR A:0x6a01344c
y.create.l HWIO_WCSS_A_MPI_WATCHDOG_ALARM_ADDR A:0x6a013450
y.create.l HWIO_WCSS_A_MPI_COMMAND_ALARM_ADDR A:0x6a013454
y.create.l HWIO_WCSS_A_MPI_TXP_ABORT_ADDR A:0x6a013458
y.create.l HWIO_WCSS_A_MPI_TXCTL_ABORT_ADDR A:0x6a01345c
y.create.l HWIO_WCSS_A_MTU_DIFS_LIMIT_0TO3_ADDR A:0x6a081400
y.create.l HWIO_WCSS_A_MTU_DIFS_LIMIT_4TO7_ADDR A:0x6a081404
y.create.l HWIO_WCSS_A_MTU_EIFS_PIFS_SLOT_LIMIT_ADDR A:0x6a081408
y.create.l HWIO_WCSS_A_MTU_SW_MTU_BCN_SLOT_USEC_SIFS_LIMIT_ADDR A:0x6a08140c
y.create.l HWIO_WCSS_A_MTU_SW_MTU_MISC_LIMITS_ADDR A:0x6a081410
y.create.l HWIO_WCSS_A_MTU_NAV_CNT_ADDR A:0x6a081414
y.create.l HWIO_WCSS_A_MTU_TSF_TIMER_LO_ADDR A:0x6a081418
y.create.l HWIO_WCSS_A_MTU_TSF_TIMER_HI_ADDR A:0x6a08141c
y.create.l HWIO_WCSS_A_MTU_TIMER_0_ADDR A:0x6a081420
y.create.l HWIO_WCSS_A_MTU_TIMER_1_ADDR A:0x6a081424
y.create.l HWIO_WCSS_A_MTU_TIMER_2_ADDR A:0x6a081428
y.create.l HWIO_WCSS_A_MTU_TIMER_3_ADDR A:0x6a08142c
y.create.l HWIO_WCSS_A_MTU_TIMER_4_ADDR A:0x6a081430
y.create.l HWIO_WCSS_A_MTU_TIMER_5_ADDR A:0x6a081434
y.create.l HWIO_WCSS_A_MTU_TIMER_6_ADDR A:0x6a081438
y.create.l HWIO_WCSS_A_MTU_TIMER_7_ADDR A:0x6a08143c
y.create.l HWIO_WCSS_A_MTU_TIMER_CONTROL_ADDR A:0x6a081440
y.create.l HWIO_WCSS_A_MTU_BKOF_CNT_0_ADDR A:0x6a081444
y.create.l HWIO_WCSS_A_MTU_BKOF_CNT_1_ADDR A:0x6a081448
y.create.l HWIO_WCSS_A_MTU_BKOF_CNT_2_ADDR A:0x6a08144c
y.create.l HWIO_WCSS_A_MTU_BKOF_CNT_3_ADDR A:0x6a081450
y.create.l HWIO_WCSS_A_MTU_BKOF_CNT_4_ADDR A:0x6a081454
y.create.l HWIO_WCSS_A_MTU_BKOF_CNT_5_ADDR A:0x6a081458
y.create.l HWIO_WCSS_A_MTU_BKOF_CNT_6_ADDR A:0x6a08145c
y.create.l HWIO_WCSS_A_MTU_BKOF_CNT_7_ADDR A:0x6a081460
y.create.l HWIO_WCSS_A_MTU_BKOF_CONTROL_ADDR A:0x6a081464
y.create.l HWIO_WCSS_A_MTU_CW_REG_CONTROL_FOR_BACKOFF_0_ADDR A:0x6a081468
y.create.l HWIO_WCSS_A_MTU_CW_REG_CONTROL_FOR_BACKOFF_1_ADDR A:0x6a08146c
y.create.l HWIO_WCSS_A_MTU_CW_REG_CONTROL_FOR_BACKOFF_2_ADDR A:0x6a081470
y.create.l HWIO_WCSS_A_MTU_CW_REG_CONTROL_FOR_BACKOFF_3_ADDR A:0x6a081474
y.create.l HWIO_WCSS_A_MTU_CW_REG_CONTROL_FOR_BACKOFF_4_ADDR A:0x6a081478
y.create.l HWIO_WCSS_A_MTU_CW_REG_CONTROL_FOR_BACKOFF_5_ADDR A:0x6a08147c
y.create.l HWIO_WCSS_A_MTU_CW_REG_CONTROL_FOR_BACKOFF_6_ADDR A:0x6a081480
y.create.l HWIO_WCSS_A_MTU_CW_REG_CONTROL_FOR_BACKOFF_7_ADDR A:0x6a081484
y.create.l HWIO_WCSS_A_MTU_MTU_INTERRUPT_STATUS_ADDR A:0x6a081488
y.create.l HWIO_WCSS_A_MTU_SW_MATCH_REGISTER_0_ADDR A:0x6a08148c
y.create.l HWIO_WCSS_A_MTU_SW_MATCH_REGISTER_1_ADDR A:0x6a081490
y.create.l HWIO_WCSS_A_MTU_SW_MATCH_REGISTER_2_ADDR A:0x6a081494
y.create.l HWIO_WCSS_A_MTU_SW_MATCH_REGISTER_3_ADDR A:0x6a081498
y.create.l HWIO_WCSS_A_MTU_SW_MATCH_REGISTER_4_ADDR A:0x6a08149c
y.create.l HWIO_WCSS_A_MTU_SW_MATCH_REGISTER_5_ADDR A:0x6a0814a0
y.create.l HWIO_WCSS_A_MTU_SW_MATCH_REGISTER_6_ADDR A:0x6a0814a4
y.create.l HWIO_WCSS_A_MTU_SW_MATCH_REGISTER_7_ADDR A:0x6a0814a8
y.create.l HWIO_WCSS_A_MTU_SW_CW_MIN_CW_MAX_0_ADDR A:0x6a0814ac
y.create.l HWIO_WCSS_A_MTU_SW_CW_MIN_CW_MAX_1_ADDR A:0x6a0814b0
y.create.l HWIO_WCSS_A_MTU_SW_CW_MIN_CW_MAX_2_ADDR A:0x6a0814b4
y.create.l HWIO_WCSS_A_MTU_SW_CW_MIN_CW_MAX_3_ADDR A:0x6a0814b8
y.create.l HWIO_WCSS_A_MTU_SW_CW_MIN_CW_MAX_4_ADDR A:0x6a0814bc
y.create.l HWIO_WCSS_A_MTU_SW_CW_MIN_CW_MAX_5_ADDR A:0x6a0814c0
y.create.l HWIO_WCSS_A_MTU_SW_CW_MIN_CW_MAX_6_ADDR A:0x6a0814c4
y.create.l HWIO_WCSS_A_MTU_SW_CW_MIN_CW_MAX_7_ADDR A:0x6a0814c8
y.create.l HWIO_WCSS_A_MTU_CCA_COUNTER0_ADDR A:0x6a0814cc
y.create.l HWIO_WCSS_A_MTU_CCA_COUNTER1_ADDR A:0x6a0814d0
y.create.l HWIO_WCSS_A_MTU_CCA_COUNTER2_ADDR A:0x6a0814d4
y.create.l HWIO_WCSS_A_MTU_WATCH_DOG_TIMER_ADDR A:0x6a0814d8
y.create.l HWIO_WCSS_A_MTU_WATCH_DOG_THR0_ADDR A:0x6a0814dc
y.create.l HWIO_WCSS_A_MTU_WATCH_DOG_THR1_ADDR A:0x6a0814e0
y.create.l HWIO_WCSS_A_MTU_WATCH_DOG_THR2_ADDR A:0x6a0814e4
y.create.l HWIO_WCSS_A_MTU_BKOF_SW_INT_TYPE_ADDR A:0x6a0814e8
y.create.l HWIO_WCSS_A_MTU_CCA_CONTROL_REG_ADDR A:0x6a0814ec
y.create.l HWIO_WCSS_A_MTU_TIMER_8_ADDR A:0x6a0814f0
y.create.l HWIO_WCSS_A_MTU_TIMER_9_ADDR A:0x6a0814f4
y.create.l HWIO_WCSS_A_MTU_TIMER_10_ADDR A:0x6a0814f8
y.create.l HWIO_WCSS_A_MTU_TIMER_11_ADDR A:0x6a0814fc
y.create.l HWIO_WCSS_A_MTU_SW_MATCH_REGISTER_8_ADDR A:0x6a081510
y.create.l HWIO_WCSS_A_MTU_SW_MATCH_REGISTER_9_ADDR A:0x6a081514
y.create.l HWIO_WCSS_A_MTU_SW_MATCH_REGISTER_10_ADDR A:0x6a081518
y.create.l HWIO_WCSS_A_MTU_SW_MATCH_REGISTER_11_ADDR A:0x6a08151c
y.create.l HWIO_WCSS_A_MTU_BKOF_CONTROL2_ADDR A:0x6a081534
y.create.l HWIO_WCSS_A_MTU_CCA_CONTROL_REG2_ADDR A:0x6a081538
y.create.l HWIO_WCSS_A_MTU_TIMER_CONTROL11TO8_ADDR A:0x6a08154c
y.create.l HWIO_WCSS_A_MTU_MTU_GLOBAL_CONTROL_ADDR A:0x6a081550
y.create.l HWIO_WCSS_A_MTU_MTU_INTERRUPT_STATUS11TO8_ADDR A:0x6a081554
y.create.l HWIO_WCSS_A_MTU_MTU_GLOBAL_CONTROL2_ADDR A:0x6a081558
y.create.l HWIO_WCSS_A_MTU_SW_MTU_SHADOW_NAV_CNT_ADDR A:0x6a08155c
y.create.l HWIO_WCSS_A_MTU_PRIMARY_CCA_HISTOGRAM_LO_ADDR A:0x6a081560
y.create.l HWIO_WCSS_A_MTU_PRIMARY_CCA_HISTOGRAM_HI_ADDR A:0x6a081564
y.create.l HWIO_WCSS_A_MTU_SECONDARY_CCA_HISTOGRAM_LO_ADDR A:0x6a081568
y.create.l HWIO_WCSS_A_MTU_SECONDARY_CCA_HISTOGRAM_HI_ADDR A:0x6a08156c
y.create.l HWIO_WCSS_A_MTU_TIMEOUT_LIMIT_ADDR A:0x6a081570
y.create.l HWIO_WCSS_A_MTU_CCA_FINAL_CONTROL_REG_ADDR A:0x6a081574
y.create.l HWIO_WCSS_A_MTU_EARLY_INTERRUPT_LIMITS_ADDR A:0x6a08157c
y.create.l HWIO_WCSS_A_MTU_BTC_CONFIG_REGISTERS_ADDR A:0x6a081580
y.create.l HWIO_WCSS_A_MTU_MTU_TESTBUS_LOW_ADDR A:0x6a081584
y.create.l HWIO_WCSS_A_MTU_MTU_TESTBUS_HIGH_ADDR A:0x6a081588
y.create.l HWIO_WCSS_A_MTU_MTU_FOR_HMAC_CONTROLS_ADDR A:0x6a08158c
y.create.l HWIO_WCSS_A_MTU_MTU_DTIM_CNT_AND_PERIOD_ADDR A:0x6a081590
y.create.l HWIO_WCSS_A_MTU_DTIM_THRSH_CNT_AND_LIMIT_ADDR A:0x6a081594
y.create.l HWIO_WCSS_A_MTU_TBTT_L_ADDR A:0x6a081598
y.create.l HWIO_WCSS_A_MTU_TBTT_H_ADDR A:0x6a08159c
y.create.l HWIO_WCSS_A_MTU_M_TBTT_L_ADDR A:0x6a0815a0
y.create.l HWIO_WCSS_A_MTU_M_TBTT_H_ADDR A:0x6a0815a4
y.create.l HWIO_WCSS_A_MTU_BCN_BSSID_INTV_ADDR A:0x6a0815a8
y.create.l HWIO_WCSS_A_MTU_VALID_BSSID_BITMAP_ADDR A:0x6a0815ac
y.create.l HWIO_WCSS_A_MTU_IBSS_BKOF_CNT_ADDR A:0x6a0815b0
y.create.l HWIO_WCSS_A_MTU_LFSR_DATA_1_0_ADDR A:0x6a0815b4
y.create.l HWIO_WCSS_A_MTU_LFSR_DATA_3_2_ADDR A:0x6a0815b8
y.create.l HWIO_WCSS_A_MTU_LFSR_DATA_5_4_ADDR A:0x6a0815bc
y.create.l HWIO_WCSS_A_MTU_LFSR_DATA_7_6_ADDR A:0x6a0815c0
y.create.l HWIO_WCSS_A_MTU_LONG_SHORT_XMIT_LIMIT_BKOF_3_TO_0_ADDR A:0x6a0815c4
y.create.l HWIO_WCSS_A_MTU_LONG_SHORT_XMIT_LIMIT_BKOF_7_TO_4_ADDR A:0x6a0815c8
y.create.l HWIO_WCSS_A_MTU_WARMUP_LIMIT_ADDR A:0x6a0815cc
y.create.l HWIO_WCSS_A_MTU_ONE_SEC_LIMIT_ADDR A:0x6a0815d0
y.create.l HWIO_WCSS_A_MTU_MTU_GLOBAL_TIMER_ADDR A:0x6a0815d4
y.create.l HWIO_WCSS_A_MTU_TSF_TIMER_FOR_SIM_BSS_LO_ADDR A:0x6a0815d8
y.create.l HWIO_WCSS_A_MTU_TSF_TIMER_FOR_SIM_BSS_HI_ADDR A:0x6a0815dc
y.create.l HWIO_WCSS_A_MTU_SW_MTU_SIFS_LIMIT_FORINNAV_ADDR A:0x6a0815e0
y.create.l HWIO_WCSS_A_MTU_SW_MTU_P2P_GO_TSF_TIMER_LO_ADDR A:0x6a0815e4
y.create.l HWIO_WCSS_A_MTU_SW_MTU_P2P_GO_TSF_TIMER_HI_ADDR A:0x6a0815e8
y.create.l HWIO_WCSS_A_MTU_SW_MTU_P2P_CLIENT_TSF_TIMER_LO_ADDR A:0x6a0815ec
y.create.l HWIO_WCSS_A_MTU_SW_MTU_P2P_CLIENT_TSF_TIMER_HI_ADDR A:0x6a0815f0
y.create.l HWIO_WCSS_A_MTU_SW_MTU_P2P_CTRL_ADDR A:0x6a0815f4
y.create.l HWIO_WCSS_A_MTU_SW_MTU_P2P_TRANSMIT_BOUNDARY_ADDR A:0x6a0815f8
y.create.l HWIO_WCSS_A_MTU_SW_MTU_P2P_WAIT_FOR_BEACON_ADDR A:0x6a0815fc
y.create.l HWIO_WCSS_A_MTU_TERTIARY_CCA_HISTOGRAM_LO_ADDR A:0x6a081600
y.create.l HWIO_WCSS_A_MTU_TERTIARY_CCA_HISTOGRAM_HI_ADDR A:0x6a081604
y.create.l HWIO_WCSS_A_MTU_QUATERNARY_CCA_HISTOGRAM_LO_ADDR A:0x6a081608
y.create.l HWIO_WCSS_A_MTU_QUATERNARY_CCA_HISTOGRAM_HI_ADDR A:0x6a08160c
y.create.l HWIO_WCSS_A_MTU_MTU_CCA_CONTROL_ADDR A:0x6a081610
y.create.l HWIO_WCSS_A_MTU_MTU_CCA_STATUS_ADDR A:0x6a081614
y.create.l HWIO_WCSS_A_MTU_ADD_TSF_TIMER_LO_ADDR A:0x6a081618
y.create.l HWIO_WCSS_A_MTU_ADD_TSF_TIMER_HI_ADDR A:0x6a08161c
y.create.l HWIO_WCSS_A_MTU_TSF_TIMER_CTRL_ADDR A:0x6a081620
y.create.l HWIO_WCSS_A_MTU_MTU_LTE_CXM_TSF_LOW_ADDR A:0x6a081624
y.create.l HWIO_WCSS_A_MTU_MTU_LTE_CXM_TSF_HIGH_ADDR A:0x6a081628
y.create.l HWIO_WCSS_A_MTU_SW_SECONDARY_CCA_HISTOGRAM_MASK_ADDR A:0x6a08162c
y.create.l HWIO_WCSS_A_MTU_SW_TERTIARY_CCA_HISTOGRAM_MASK_ADDR A:0x6a081630
y.create.l HWIO_WCSS_A_MTU_SW_QUATERNARY_CCA_HISTOGRAM_MASK_ADDR A:0x6a081634
y.create.l HWIO_WCSS_A_MTU_SW_CCA_HISTOGRAM_MASK_MISC_ADDR A:0x6a081638
y.create.l HWIO_WCSS_A_MTU_CCA_SECONDARY_HISTOGRAM_ADDR A:0x6a08163c
y.create.l HWIO_WCSS_A_MTU_CCA_TERTIARY_HISTOGRAM_ADDR A:0x6a081640
y.create.l HWIO_WCSS_A_MTU_CCA_QUATERNARY_HISTOGRAM_ADDR A:0x6a081644
y.create.l HWIO_WCSS_A_MTU_MTU_MISC_FOR_TVWS_1_ADDR A:0x6a081648
y.create.l HWIO_WCSS_A_MTU_CCA_COUNTER3_ADDR A:0x6a08164c
y.create.l HWIO_WCSS_A_MTU_CCA_COUNTER4_ADDR A:0x6a081650
y.create.l HWIO_WCSS_A_MTU_CCA_COUNTER5_ADDR A:0x6a081654
y.create.l HWIO_WCSS_A_MTU_BSS2_CLIENT_TSF_TIMER_LO_ADDR A:0x6a081658
y.create.l HWIO_WCSS_A_MTU_BSS2_CLIENT_TSF_TIMER_HI_ADDR A:0x6a08165c
y.create.l HWIO_WCSS_A_MTU_QBOOST_CONTROL_ADDR A:0x6a081660
y.create.l HWIO_WCSS_A_MTU_SW_MTU_P2P_TRANSMIT_BOUNDARY2_ADDR A:0x6a081664
y.create.l HWIO_WCSS_A_MTU_SW_MTU_P2P_TRANSMIT_BOUNDARY3_ADDR A:0x6a081668
y.create.l HWIO_WCSS_A_MTU_SW_MTU_P2P_TRANSMIT_BOUNDARY4_ADDR A:0x6a08166c
y.create.l HWIO_WCSS_A_PHYDBG_CFGMODE_ADDR A:0x6a004000
y.create.l HWIO_WCSS_A_PHYDBG_SELTRIG_ADDR A:0x6a004004
y.create.l HWIO_WCSS_A_PHYDBG_RST0_ADDR A:0x6a004008
y.create.l HWIO_WCSS_A_PHYDBG_RST1_ADDR A:0x6a00400c
y.create.l HWIO_WCSS_A_PHYDBG_START0_ADDR A:0x6a004010
y.create.l HWIO_WCSS_A_PHYDBG_START1_ADDR A:0x6a004014
y.create.l HWIO_WCSS_A_PHYDBG_STATUS_ADDR A:0x6a004018
y.create.l HWIO_WCSS_A_PHYDBG_DELAY0_ADDR A:0x6a00401c
y.create.l HWIO_WCSS_A_PHYDBG_TRIGPTR0_ADDR A:0x6a004020
y.create.l HWIO_WCSS_A_PHYDBG_TMUX_STRBQUAL_ADDR A:0x6a004024
y.create.l HWIO_WCSS_A_PHYDBG_CAPT_CFG_ADDR A:0x6a004028
y.create.l HWIO_WCSS_A_PHYDBG_CAPT_CFG2_ADDR A:0x6a00402c
y.create.l HWIO_WCSS_A_PHYDBG_START_TRIGWD0_ADDR A:0x6a004030
y.create.l HWIO_WCSS_A_PHYDBG_END_TRIGWD0_ADDR A:0x6a004034
y.create.l HWIO_WCSS_A_PHYDBG_STOP_TRIGWD0_ADDR A:0x6a004038
y.create.l HWIO_WCSS_A_PHYDBG_START_ADDR0_ADDR A:0x6a00403c
y.create.l HWIO_WCSS_A_PHYDBG_MAX_ADDR0_ADDR A:0x6a004040
y.create.l HWIO_WCSS_A_PHYDBG_START_ADDR1_ADDR A:0x6a004044
y.create.l HWIO_WCSS_A_PHYDBG_MAX_ADDR1_ADDR A:0x6a004048
y.create.l HWIO_WCSS_A_PHYDBG_AGCRST_ADDR A:0x6a00404c
y.create.l HWIO_WCSS_A_PHYDBG_TMUX_STRIG_ADDR A:0x6a004050
y.create.l HWIO_WCSS_A_PHYDBG_TMUX_ETRIG_ADDR A:0x6a004054
y.create.l HWIO_WCSS_A_PHYDBG_PLYBCK_CFG_ADDR A:0x6a004058
y.create.l HWIO_WCSS_A_PHYDBG_PLYBCK_CFG2_ADDR A:0x6a00405c
y.create.l HWIO_WCSS_A_PHYDBG_PRBS_ADDR A:0x6a004060
y.create.l HWIO_WCSS_A_PHYDBG_PRBS_MS_ADDR A:0x6a004064
y.create.l HWIO_WCSS_A_PHYDBG_PRBS_LOAD_ADDR A:0x6a004068
y.create.l HWIO_WCSS_A_PHYDBG_TXPKT_CNT_ADDR A:0x6a00406c
y.create.l HWIO_WCSS_A_PHYDBG_RXPKT_CNT_ADDR A:0x6a004070
y.create.l HWIO_WCSS_A_PHYDBG_CAPTCNT_ADDR A:0x6a004074
y.create.l HWIO_WCSS_A_PHYDBG_POSTTRIGCNT_ADDR A:0x6a004078
y.create.l HWIO_WCSS_A_PHYDBG_WARMUP_DLY_ADDR A:0x6a00407c
y.create.l HWIO_WCSS_A_PHYDBG_RXPKT_FILTER_10_ADDR A:0x6a004080
y.create.l HWIO_WCSS_A_PHYDBG_RXPKT_FILTER_32_ADDR A:0x6a004084
y.create.l HWIO_WCSS_A_PHYDBG_PLYBKCNT_ADDR A:0x6a004088
y.create.l HWIO_WCSS_A_PHYDBG_AMPDU_RXPKT_CNT_ADDR A:0x6a00408c
y.create.l HWIO_WCSS_A_PHYDBG_AUTO_TRIG_PLAYBACK1_ADDR A:0x6a004090
y.create.l HWIO_WCSS_A_PHYDBG_AUTO_TRIG_PLAYBACK_DELAY1_ADDR A:0x6a004094
y.create.l HWIO_WCSS_A_PHYDBG_AUTO_TRIG_PLAYBACK_TIMEOUT_DELAY1_ADDR A:0x6a004098
y.create.l HWIO_WCSS_A_PHYDBG_GPIO_OUT_TRIG_ADDR A:0x6a00409c
y.create.l HWIO_WCSS_A_PHYDBG_AUTO_CAPT_CNT_ADDR A:0x6a0040a0
y.create.l HWIO_WCSS_A_PHYDBG_DBGMEM0_0_ADDR A:0x6a006000
y.create.l HWIO_WCSS_A_PHYDBG_DBGMEM1_0_ADDR A:0x6a006008
y.create.l HWIO_WCSS_A_PHYDBG_DBGMEM2_0_ADDR A:0x6a006010
y.create.l HWIO_WCSS_A_PHYDBG_DBGMEM3_0_ADDR A:0x6a006018
y.create.l HWIO_WCSS_A_PHYDBG_DBGMEM4_0_ADDR A:0x6a006020
y.create.l HWIO_WCSS_A_PHYDBG_DBGMEM5_0_ADDR A:0x6a006028
y.create.l HWIO_WCSS_A_PHYDBG_DBGMEM6_0_ADDR A:0x6a006030
y.create.l HWIO_WCSS_A_PHYDBG_DBGMEM7_0_ADDR A:0x6a006038
y.create.l HWIO_WCSS_A_PHYDBG_DBGMEM8_0_ADDR A:0x6a006040
y.create.l HWIO_WCSS_A_PHYDBG_DBGMEM9_0_ADDR A:0x6a006048
y.create.l HWIO_WCSS_A_PHYDBG_DBGMEM0_1_ADDR A:0x6a006004
y.create.l HWIO_WCSS_A_PHYDBG_DBGMEM1_1_ADDR A:0x6a00600c
y.create.l HWIO_WCSS_A_PHYDBG_DBGMEM2_1_ADDR A:0x6a006014
y.create.l HWIO_WCSS_A_PHYDBG_DBGMEM3_1_ADDR A:0x6a00601c
y.create.l HWIO_WCSS_A_PHYDBG_DBGMEM4_1_ADDR A:0x6a006024
y.create.l HWIO_WCSS_A_PHYDBG_DBGMEM5_1_ADDR A:0x6a00602c
y.create.l HWIO_WCSS_A_PHYDBG_DBGMEM6_1_ADDR A:0x6a006034
y.create.l HWIO_WCSS_A_PHYDBG_DBGMEM7_1_ADDR A:0x6a00603c
y.create.l HWIO_WCSS_A_PHYDBG_DBGMEM8_1_ADDR A:0x6a006044
y.create.l HWIO_WCSS_A_PHYDBG_DBGMEM9_1_ADDR A:0x6a00604c
y.create.l HWIO_WCSS_A_PHYINT_STATUS_ADDR A:0x6a015c00
y.create.l HWIO_WCSS_A_PHYINT_FAST_MASK_ADDR A:0x6a015c04
y.create.l HWIO_WCSS_A_PHYINT_SLOW_MASK_ADDR A:0x6a015c08
y.create.l HWIO_WCSS_A_PHYINT_HOST_MASK_ADDR A:0x6a015c0c
y.create.l HWIO_WCSS_A_PMI_PMI_STATE_ADDR A:0x6a013800
y.create.l HWIO_WCSS_A_PMI_RXA_PKTS_ADDR A:0x6a013804
y.create.l HWIO_WCSS_A_PMI_RXB_PACKETS_ADDR A:0x6a01380c
y.create.l HWIO_WCSS_A_PMI_RXA_DATA_VALID_ADDR A:0x6a013810
y.create.l HWIO_WCSS_A_PMI_RXB_DATA_VALID_ADDR A:0x6a013814
y.create.l HWIO_WCSS_A_PMI_RXP_SHUTOFF_ADDR A:0x6a013818
y.create.l HWIO_WCSS_A_PMI_RXP_MU_EOP_ADDR A:0x6a01381c
y.create.l HWIO_WCSS_A_PMI_PHY_STARTS_ADDR A:0x6a013820
y.create.l HWIO_WCSS_A_PMI_PHY_DATA_VAL_ADDR A:0x6a013824
y.create.l HWIO_WCSS_A_PMI_PHY_ABORT_ADDR A:0x6a013828
y.create.l HWIO_WCSS_A_PMI_PHY_INT_ADDR A:0x6a01382c
y.create.l HWIO_WCSS_A_PMI_WATCHDOG_TIMEOUT_GENERAL_ADDR A:0x6a013830
y.create.l HWIO_WCSS_A_PMI_WATCHDOG_TIMEOUT_11A_ADDR A:0x6a013834
y.create.l HWIO_WCSS_A_PMI_WATCHDOG_TIMEOUT_11B_ADDR A:0x6a013838
y.create.l HWIO_WCSS_A_PMI_DISABLE_FLAGS_ADDR A:0x6a01383c
y.create.l HWIO_WCSS_A_PMI_CRC_FSM_RESET_ADDR A:0x6a013840
y.create.l HWIO_WCSS_A_PMI_RXPKT_FILTER_LSW_ADDR A:0x6a013844
y.create.l HWIO_WCSS_A_PMI_RXPKT_FILTER_MSW_ADDR A:0x6a013848
y.create.l HWIO_WCSS_A_PMI_CRC_DONE_ADDR A:0x6a01384c
y.create.l HWIO_WCSS_A_PMI_CRC_PASS_ADDR A:0x6a013850
y.create.l HWIO_WCSS_A_PMI_AMPDU_BAD_ADDR A:0x6a013854
y.create.l HWIO_WCSS_A_PMI_AMPDU_GOOD_ADDR A:0x6a013858
y.create.l HWIO_WCSS_A_PMI_AMPDU_DONE_ADDR A:0x6a01385c
y.create.l HWIO_WCSS_A_PMI_LAST_STATS0_ADDR A:0x6a013860
y.create.l HWIO_WCSS_A_PMI_LAST_STATS1_ADDR A:0x6a013864
y.create.l HWIO_WCSS_A_PMI_LAST_STATS2_ADDR A:0x6a013868
y.create.l HWIO_WCSS_A_PMI_LAST_STATS3_ADDR A:0x6a01386c
y.create.l HWIO_WCSS_A_QTA_INTR_ADDR A:0x6a080fc0
y.create.l HWIO_WCSS_A_QTA_INTR_EN_ADDR A:0x6a080fc4
y.create.l HWIO_WCSS_A_QTA_UART_CTRL_ADDR A:0x6a080fc8
y.create.l HWIO_WCSS_A_QTA_HW_CTRL_ADDR A:0x6a080fcc
y.create.l HWIO_WCSS_A_QTA_HW_TX_BUFFER_MODIFY_ADDR A:0x6a080fd0
y.create.l HWIO_WCSS_A_QTA_SW_CTRL_ADDR A:0x6a080fd4
y.create.l HWIO_WCSS_A_QTA_SW_TX_FIFO_IN_ADDR A:0x6a080fd8
y.create.l HWIO_WCSS_A_QTA_SW_RX_FIFO_OUT_ADDR A:0x6a080fdc
y.create.l HWIO_WCSS_A_QTA_TESTBUS_ADDR A:0x6a080fe0
y.create.l HWIO_WCSS_A_RACTL_PTC_LOOP_EN_ADDR A:0x6a00f000
y.create.l HWIO_WCSS_A_RACTL_PTC_LOOP_GAIN_ADDR A:0x6a00f004
y.create.l HWIO_WCSS_A_RACTL_PTC_CHAN_FREQ_ADDR A:0x6a00f008
y.create.l HWIO_WCSS_A_RACTL_RACTL_CFG_ADDR A:0x6a00f00c
y.create.l HWIO_WCSS_A_RACTL_RXA_ABORT_ADDR A:0x6a00f010
y.create.l HWIO_WCSS_A_RACTL_RACTL_TOFFSET_ADDR A:0x6a00f014
y.create.l HWIO_WCSS_A_RACTL_RACTL_DELTAT_IN_ADDR A:0x6a00f018
y.create.l HWIO_WCSS_A_RACTL_RACTL_DELTAT_OUT_ADDR A:0x6a00f01c
y.create.l HWIO_WCSS_A_RACTL_RACTL_DELTAF_IN_ADDR A:0x6a00f020
y.create.l HWIO_WCSS_A_RACTL_RACTL_DELTAF_OUT_ADDR A:0x6a00f024
y.create.l HWIO_WCSS_A_RACTL_PTC_DELTAAMP_TIMINGOFFSET_OUT_ADDR A:0x6a00f028
y.create.l HWIO_WCSS_A_RACTL_RACTL_TEST_SIG_LEN_ADDR A:0x6a00f02c
y.create.l HWIO_WCSS_A_RACTL_RACTL_TEST_CFG_ADDR A:0x6a00f030
y.create.l HWIO_WCSS_A_RACTL_TESTMUX_SEL_ADDR A:0x6a00f034
y.create.l HWIO_WCSS_A_RACTL_RACTL_PKTCOUNT_ADDR A:0x6a00f038
y.create.l HWIO_WCSS_A_RACTL_RACTL_SYMCOUNT_ADDR A:0x6a00f03c
y.create.l HWIO_WCSS_A_RACTL_RACTL_PKTCOUNT_AC20_ADDR A:0x6a00f040
y.create.l HWIO_WCSS_A_RACTL_RACTL_PKTCOUNT_AC40_ADDR A:0x6a00f044
y.create.l HWIO_WCSS_A_RACTL_RACTL_PKTCOUNT_AC80_ADDR A:0x6a00f048
y.create.l HWIO_WCSS_A_RACTL_RACTL_PKTCOUNT_AC_SU_ADDR A:0x6a00f04c
y.create.l HWIO_WCSS_A_RACTL_RACTL_PKTCOUNT_AC_MU_ADDR A:0x6a00f050
y.create.l HWIO_WCSS_A_RACTL_CHE_PKTCOUNT_ADDR A:0x6a00f054
y.create.l HWIO_WCSS_A_RACTL_PTC_PKTCOUNT_ADDR A:0x6a00f058
y.create.l HWIO_WCSS_A_RACTL_PTC_SYMCOUNT_ADDR A:0x6a00f05c
y.create.l HWIO_WCSS_A_RACTL_PTC_PKTCOUNT_20M_ADDR A:0x6a00f060
y.create.l HWIO_WCSS_A_RACTL_PTC_PKTCOUNT_40M_ADDR A:0x6a00f064
y.create.l HWIO_WCSS_A_RACTL_PTC_PKTCOUNT_SIMO_ADDR A:0x6a00f068
y.create.l HWIO_WCSS_A_RACTL_PTC_PKTCOUNT_STBC_ADDR A:0x6a00f06c
y.create.l HWIO_WCSS_A_RACTL_PTC_PKTCOUNT_GF_ADDR A:0x6a00f070
y.create.l HWIO_WCSS_A_RACTL_PTC_PKTCOUNT_MM_ADDR A:0x6a00f074
y.create.l HWIO_WCSS_A_RACTL_FFT_OPSCALE_ADDR A:0x6a00f078
y.create.l HWIO_WCSS_A_RACTL_RACTL_STATE_ADDR A:0x6a00f07c
y.create.l HWIO_WCSS_A_RACTL_AGC_ABORT_COUNT_ADDR A:0x6a00f080
y.create.l HWIO_WCSS_A_RACTL_SIGNAL_INVALID_COUNT_LSIG_ADDR A:0x6a00f084
y.create.l HWIO_WCSS_A_RACTL_SERV_INVALID_COUNT_ADDR A:0x6a00f088
y.create.l HWIO_WCSS_A_RACTL_INTERRUPT_COUNT_ADDR A:0x6a00f08c
y.create.l HWIO_WCSS_A_RACTL_LAST_LS_SIGNAL_ADDR A:0x6a00f090
y.create.l HWIO_WCSS_A_RACTL_LAST_MS_SIGNAL_ADDR A:0x6a00f094
y.create.l HWIO_WCSS_A_RACTL_LAST_MCS_ADDR A:0x6a00f098
y.create.l HWIO_WCSS_A_RACTL_STROBE_UNSUPPHTSIG_ADDR A:0x6a00f09c
y.create.l HWIO_WCSS_A_RACTL_LAST_UNSUPHTSIGNAL0_ADDR A:0x6a00f0a0
y.create.l HWIO_WCSS_A_RACTL_LAST_UNSUPHTSIGNAL1_ADDR A:0x6a00f0a4
y.create.l HWIO_WCSS_A_RACTL_LAST_UNSUPHTSIGNAL2_ADDR A:0x6a00f0a8
y.create.l HWIO_WCSS_A_RACTL_LAST_MXED_SIG0_ADDR A:0x6a00f0ac
y.create.l HWIO_WCSS_A_RACTL_LAST_MXED_SIG1_ADDR A:0x6a00f0b0
y.create.l HWIO_WCSS_A_RACTL_LAST_MXED_SIG2_ADDR A:0x6a00f0b4
y.create.l HWIO_WCSS_A_RACTL_STATISTICS_SELECT_ADDR A:0x6a00f0b8
y.create.l HWIO_WCSS_A_RACTL_DAGC_TGTBO_ADDR A:0x6a00f0bc
y.create.l HWIO_WCSS_A_RACTL_CMDWDFILL_ADDR A:0x6a00f0c0
y.create.l HWIO_WCSS_A_RACTL_RACTL_STATUS_ADDR A:0x6a00f0c4
y.create.l HWIO_WCSS_A_RACTL_NES2_MCSBOUND0_ADDR A:0x6a00f0c8
y.create.l HWIO_WCSS_A_RACTL_NES2_MCSBOUND1_ADDR A:0x6a00f0cc
y.create.l HWIO_WCSS_A_RACTL_NES2_MCSBOUND2_ADDR A:0x6a00f0d0
y.create.l HWIO_WCSS_A_RACTL_NES2_MCSBOUND3_ADDR A:0x6a00f0d4
y.create.l HWIO_WCSS_A_RACTL_LSIGLEN_LOWERBOUND_ADDR A:0x6a00f0d8
y.create.l HWIO_WCSS_A_RACTL_RACTL_INTR_EN_ADDR A:0x6a00f0dc
y.create.l HWIO_WCSS_A_RACTL_RACTL_SUPP_BWMISMCOUNT_ADDR A:0x6a00f0e0
y.create.l HWIO_WCSS_A_RACTL_PTC_TH_ADDR A:0x6a00f0e4
y.create.l HWIO_WCSS_A_RACTL_BWMISMCNTRST_ADDR A:0x6a00f0e8
y.create.l HWIO_WCSS_A_RACTL_LMAP_OPSCALE1_SISO_ADDR A:0x6a00f0f0
y.create.l HWIO_WCSS_A_RACTL_LMAP_OPSCALE2_SISO_ADDR A:0x6a00f0f4
y.create.l HWIO_WCSS_A_RACTL_LMAP_OPSCALE1_STBC_ADDR A:0x6a00f0f8
y.create.l HWIO_WCSS_A_RACTL_LMAP_OPSCALE2_STBC_ADDR A:0x6a00f0fc
y.create.l HWIO_WCSS_A_RACTL_LMAP_OPSCALE3_ADDR A:0x6a00f100
y.create.l HWIO_WCSS_A_RACTL_LMAP_TRK_CTRL_ADDR A:0x6a00f104
y.create.l HWIO_WCSS_A_RACTL_LMAP_DUPCOMB_ADDR A:0x6a00f108
y.create.l HWIO_WCSS_A_RACTL_LMAP_SNR_SEL_ADDR A:0x6a00f10c
y.create.l HWIO_WCSS_A_RACTL_RACTL_SPL_ADDR A:0x6a00f110
y.create.l HWIO_WCSS_A_RACTL_WATCHDOG1_ADDR A:0x6a00f114
y.create.l HWIO_WCSS_A_RACTL_WATCHDOG2_ADDR A:0x6a00f118
y.create.l HWIO_WCSS_A_RACTL_WATCHDOG3_ADDR A:0x6a00f11c
y.create.l HWIO_WCSS_A_RACTL_RACTL_UNSUPP_BWMISMCOUNT_ADDR A:0x6a00f120
y.create.l HWIO_WCSS_A_RACTL_RACTL_LAST_BW_ADDR A:0x6a00f124
y.create.l HWIO_WCSS_A_RACTL_RACTL_MINSNRSTATS_ADDR A:0x6a00f130
y.create.l HWIO_WCSS_A_RACTL_SIGNAL_INVALID_COUNT_HTSIG_ADDR A:0x6a00f140
y.create.l HWIO_WCSS_A_RACTL_RXFIR_SCALING_COEFF_ADDR A:0x6a00f144
y.create.l HWIO_WCSS_A_RACTL_CSI_CODEBOOK_SNR_TH_ADDR A:0x6a00f148
y.create.l HWIO_WCSS_A_RACTL_CSI_CONFIG_ADDR A:0x6a00f14c
y.create.l HWIO_WCSS_A_RACTL_BF_GAIN_DENOM_ADDR A:0x6a00f150
y.create.l HWIO_WCSS_A_RACTL_CSI_STATS1_ADDR A:0x6a00f154
y.create.l HWIO_WCSS_A_RACTL_CSI_STATS2_ADDR A:0x6a00f158
y.create.l HWIO_WCSS_A_RACTL_CHE_SMOOTHING_ADDR A:0x6a00f15c
y.create.l HWIO_WCSS_A_RACTL_PKTCNT_SMOOTHED_ADDR A:0x6a00f160
y.create.l HWIO_WCSS_A_RACTL_RACTL_CRCCHKCFG_ADDR A:0x6a00f164
y.create.l HWIO_WCSS_A_RACTL_RACTL_DBG_ADDR A:0x6a00f168
y.create.l HWIO_WCSS_A_RACTL_FORCE_DBGPKTTYPE_ADDR A:0x6a00f16c
y.create.l HWIO_WCSS_A_RACTL_RACTL_MU_ADDR A:0x6a00f170
y.create.l HWIO_WCSS_A_RACTL_VIT_LSIG_ADDR A:0x6a00f174
y.create.l HWIO_WCSS_A_RACTL_MCSFBSNRTH1_ADDR A:0x6a00f180
y.create.l HWIO_WCSS_A_RACTL_MCSFBSNRTH2_ADDR A:0x6a00f184
y.create.l HWIO_WCSS_A_RACTL_MCSFBSNRTH3_ADDR A:0x6a00f188
y.create.l HWIO_WCSS_A_RACTL_MCSFBSNRTH4_ADDR A:0x6a00f18c
y.create.l HWIO_WCSS_A_RACTL_MCSFBSNRTH5_ADDR A:0x6a00f190
y.create.l HWIO_WCSS_A_RACTL_MCSFBSNRTH6_ADDR A:0x6a00f194
y.create.l HWIO_WCSS_A_RACTL_MCSFBSNRTH7_ADDR A:0x6a00f198
y.create.l HWIO_WCSS_A_RACTL_MCSFBSNRTH8_ADDR A:0x6a00f19c
y.create.l HWIO_WCSS_A_RACTL_MCSFBSNRTH9_ADDR A:0x6a00f1a0
y.create.l HWIO_WCSS_A_RACTL_MSA_REG0_ADDR A:0x6a00f1a4
y.create.l HWIO_WCSS_A_RACTL_MSA_REG1_ADDR A:0x6a00f1a8
y.create.l HWIO_WCSS_A_RACTL_MSA_REG2_ADDR A:0x6a00f1ac
y.create.l HWIO_WCSS_A_RACTL_MSA_REG3_ADDR A:0x6a00f1b0
y.create.l HWIO_WCSS_A_RACTL_UPA_REG0_ADDR A:0x6a00f1b4
y.create.l HWIO_WCSS_A_RACTL_UPA_REG1_ADDR A:0x6a00f1b8
y.create.l HWIO_WCSS_A_RACTL_UPA_REG2_ADDR A:0x6a00f1bc
y.create.l HWIO_WCSS_A_RACTL_UPA_REG3_ADDR A:0x6a00f1c0
y.create.l HWIO_WCSS_A_RACTL_UPA_REG4_ADDR A:0x6a00f1c4
y.create.l HWIO_WCSS_A_RACTL_UPA_REG5_ADDR A:0x6a00f1c8
y.create.l HWIO_WCSS_A_RACTL_UPA_REG6_ADDR A:0x6a00f1cc
y.create.l HWIO_WCSS_A_RACTL_UPA_REG7_ADDR A:0x6a00f1d0
y.create.l HWIO_WCSS_A_RBAPB_CONTROL_RXB_DSCR_ADDR A:0x6a014400
y.create.l HWIO_WCSS_A_RBAPB_COUNT_SSFD_ADDR A:0x6a014404
y.create.l HWIO_WCSS_A_RBAPB_COUNT_LSFD_ADDR A:0x6a014408
y.create.l HWIO_WCSS_A_RBAPB_IGN_ILL_PLCP_ADDR A:0x6a01440c
y.create.l HWIO_WCSS_A_RBAPB_COUNT_PLCP_CRC_ERRORS_ADDR A:0x6a014410
y.create.l HWIO_WCSS_A_RBAPB_COUNT_PLCP_SIG_ERRORS_ADDR A:0x6a014414
y.create.l HWIO_WCSS_A_RBAPB_COUNT_PLCP_SVC_ERRORS_ADDR A:0x6a014418
y.create.l HWIO_WCSS_A_RBAPB_COUNT_RX_BYTES_ADDR A:0x6a01441c
y.create.l HWIO_WCSS_A_RBAPB_COUNT_MPI_SOF_ADDR A:0x6a014420
y.create.l HWIO_WCSS_A_RBAPB_COUNT_MPI_EOF_ADDR A:0x6a014424
y.create.l HWIO_WCSS_A_RBAPB_SFD_DET_TMO_ADDR A:0x6a014428
y.create.l HWIO_WCSS_A_RBAPB_SLR_SFD_DET_TMO_ADDR A:0x6a01442c
y.create.l HWIO_WCSS_A_RBAPB_COUNT_RXB_START_ADDR A:0x6a014430
y.create.l HWIO_WCSS_A_RBAPB_COUNT_RXB_ABORT_ADDR A:0x6a014438
y.create.l HWIO_WCSS_A_RBAPB_RXB_RESET_ADDR A:0x6a01443c
y.create.l HWIO_WCSS_A_RBAPB_CONTROL_BARKER_TIMING_TRACKING_ADDR A:0x6a014440
y.create.l HWIO_WCSS_A_RBAPB_CMF_PLL_COEFF_A_ADDR A:0x6a014448
y.create.l HWIO_WCSS_A_RBAPB_CMF_PLL_COEFF_B_ADDR A:0x6a01444c
y.create.l HWIO_WCSS_A_RBAPB_CMF_PLL_COEFF_A_SLR_TRACK_ADDR A:0x6a014450
y.create.l HWIO_WCSS_A_RBAPB_CMF_PLL_COEFF_B_SLR_TRACK_ADDR A:0x6a014454
y.create.l HWIO_WCSS_A_RBAPB_ANTENNA_DIVERSITY_MODE_ADDR A:0x6a014458
y.create.l HWIO_WCSS_A_RBAPB_SNR_THRESHOLD_ADDR A:0x6a01445c
y.create.l HWIO_WCSS_A_RBAPB_SNR_AVERAGER_GAIN_ADDR A:0x6a014460
y.create.l HWIO_WCSS_A_RBAPB_LMS_AVERAGER_SHIFT_ADDR A:0x6a014464
y.create.l HWIO_WCSS_A_RBAPB_COUNT_DYNSEL_ANT0_ADDR A:0x6a014468
y.create.l HWIO_WCSS_A_RBAPB_COUNT_DYNSEL_ANT1_ADDR A:0x6a01446c
y.create.l HWIO_WCSS_A_RBAPB_COUNT_DYNSEL_2ANT_ADDR A:0x6a014470
y.create.l HWIO_WCSS_A_RFIF_RF_BUS_CONTROL_ADDR A:0x6a015000
y.create.l HWIO_WCSS_A_RFIF_RF_BUS_STATUS_ADDR A:0x6a015004
y.create.l HWIO_WCSS_A_RFIF_ARB_CONTROL_ADDR A:0x6a015008
y.create.l HWIO_WCSS_A_RFIF_ARB_COMMAND_ADDR A:0x6a01500c
y.create.l HWIO_WCSS_A_RFIF_ARB_STATUS_ADDR A:0x6a015010
y.create.l HWIO_WCSS_A_RFIF_BT_CTRL_CFG_ADDR A:0x6a015014
y.create.l HWIO_WCSS_A_RFIF_TX_EN_CFG_ADDR A:0x6a015018
y.create.l HWIO_WCSS_A_RFIF_RESET_CTRL_ADDR A:0x6a01501c
y.create.l HWIO_WCSS_A_RFIF_PHY_HW_STATUS_ADDR A:0x6a015020
y.create.l HWIO_WCSS_A_RFIF_RFAPB_STATUS_ADDR A:0x6a015024
y.create.l HWIO_WCSS_A_RFIF_ERROR_CONDS_ADDR A:0x6a015028
y.create.l HWIO_WCSS_A_RFIF_HKADC_RD_ADDR_ADDR A:0x6a01502c
y.create.l HWIO_WCSS_A_RFIF_HKADC_WR_ADDR_ADDR A:0x6a015030
y.create.l HWIO_WCSS_A_RFIF_HKADC_CONV_TIMER_ADDR A:0x6a015034
y.create.l HWIO_WCSS_A_RFIF_RX_GAIN0_0_ADDR A:0x6a015400
y.create.l HWIO_WCSS_A_RFIF_RX_GAIN1_0_ADDR A:0x6a015410
y.create.l HWIO_WCSS_A_RFIF_RX_GAIN2_0_ADDR A:0x6a015420
y.create.l HWIO_WCSS_A_RFIF_RX_GAIN3_0_ADDR A:0x6a015430
y.create.l HWIO_WCSS_A_RFIF_RX_GAIN4_0_ADDR A:0x6a015440
y.create.l HWIO_WCSS_A_RFIF_RX_GAIN5_0_ADDR A:0x6a015450
y.create.l HWIO_WCSS_A_RFIF_RX_GAIN6_0_ADDR A:0x6a015460
y.create.l HWIO_WCSS_A_RFIF_RX_GAIN7_0_ADDR A:0x6a015470
y.create.l HWIO_WCSS_A_RFIF_RX_GAIN8_0_ADDR A:0x6a015480
y.create.l HWIO_WCSS_A_RFIF_RX_GAIN9_0_ADDR A:0x6a015490
y.create.l HWIO_WCSS_A_RFIF_RX_GAIN0_1_ADDR A:0x6a015404
y.create.l HWIO_WCSS_A_RFIF_RX_GAIN1_1_ADDR A:0x6a015414
y.create.l HWIO_WCSS_A_RFIF_RX_GAIN2_1_ADDR A:0x6a015424
y.create.l HWIO_WCSS_A_RFIF_RX_GAIN3_1_ADDR A:0x6a015434
y.create.l HWIO_WCSS_A_RFIF_RX_GAIN4_1_ADDR A:0x6a015444
y.create.l HWIO_WCSS_A_RFIF_RX_GAIN5_1_ADDR A:0x6a015454
y.create.l HWIO_WCSS_A_RFIF_RX_GAIN6_1_ADDR A:0x6a015464
y.create.l HWIO_WCSS_A_RFIF_RX_GAIN7_1_ADDR A:0x6a015474
y.create.l HWIO_WCSS_A_RFIF_RX_GAIN8_1_ADDR A:0x6a015484
y.create.l HWIO_WCSS_A_RFIF_RX_GAIN9_1_ADDR A:0x6a015494
y.create.l HWIO_WCSS_A_RFIF_RX_GAIN0_2_ADDR A:0x6a015408
y.create.l HWIO_WCSS_A_RFIF_RX_GAIN1_2_ADDR A:0x6a015418
y.create.l HWIO_WCSS_A_RFIF_RX_GAIN2_2_ADDR A:0x6a015428
y.create.l HWIO_WCSS_A_RFIF_RX_GAIN3_2_ADDR A:0x6a015438
y.create.l HWIO_WCSS_A_RFIF_RX_GAIN4_2_ADDR A:0x6a015448
y.create.l HWIO_WCSS_A_RFIF_RX_GAIN5_2_ADDR A:0x6a015458
y.create.l HWIO_WCSS_A_RFIF_RX_GAIN6_2_ADDR A:0x6a015468
y.create.l HWIO_WCSS_A_RFIF_RX_GAIN7_2_ADDR A:0x6a015478
y.create.l HWIO_WCSS_A_RFIF_RX_GAIN8_2_ADDR A:0x6a015488
y.create.l HWIO_WCSS_A_RFIF_RX_GAIN9_2_ADDR A:0x6a015498
y.create.l HWIO_WCSS_A_RFIF_TX_GAIN0_0_ADDR A:0x6a015800
y.create.l HWIO_WCSS_A_RFIF_TX_GAIN1_0_ADDR A:0x6a015820
y.create.l HWIO_WCSS_A_RFIF_TX_GAIN2_0_ADDR A:0x6a015840
y.create.l HWIO_WCSS_A_RFIF_TX_GAIN3_0_ADDR A:0x6a015860
y.create.l HWIO_WCSS_A_RFIF_TX_GAIN4_0_ADDR A:0x6a015880
y.create.l HWIO_WCSS_A_RFIF_TX_GAIN5_0_ADDR A:0x6a0158a0
y.create.l HWIO_WCSS_A_RFIF_TX_GAIN6_0_ADDR A:0x6a0158c0
y.create.l HWIO_WCSS_A_RFIF_TX_GAIN7_0_ADDR A:0x6a0158e0
y.create.l HWIO_WCSS_A_RFIF_TX_GAIN8_0_ADDR A:0x6a015900
y.create.l HWIO_WCSS_A_RFIF_TX_GAIN9_0_ADDR A:0x6a015920
y.create.l HWIO_WCSS_A_RFIF_TX_GAIN0_1_ADDR A:0x6a015804
y.create.l HWIO_WCSS_A_RFIF_TX_GAIN1_1_ADDR A:0x6a015824
y.create.l HWIO_WCSS_A_RFIF_TX_GAIN2_1_ADDR A:0x6a015844
y.create.l HWIO_WCSS_A_RFIF_TX_GAIN3_1_ADDR A:0x6a015864
y.create.l HWIO_WCSS_A_RFIF_TX_GAIN4_1_ADDR A:0x6a015884
y.create.l HWIO_WCSS_A_RFIF_TX_GAIN5_1_ADDR A:0x6a0158a4
y.create.l HWIO_WCSS_A_RFIF_TX_GAIN6_1_ADDR A:0x6a0158c4
y.create.l HWIO_WCSS_A_RFIF_TX_GAIN7_1_ADDR A:0x6a0158e4
y.create.l HWIO_WCSS_A_RFIF_TX_GAIN8_1_ADDR A:0x6a015904
y.create.l HWIO_WCSS_A_RFIF_TX_GAIN9_1_ADDR A:0x6a015924
y.create.l HWIO_WCSS_A_RFIF_TX_GAIN0_2_ADDR A:0x6a015808
y.create.l HWIO_WCSS_A_RFIF_TX_GAIN1_2_ADDR A:0x6a015828
y.create.l HWIO_WCSS_A_RFIF_TX_GAIN2_2_ADDR A:0x6a015848
y.create.l HWIO_WCSS_A_RFIF_TX_GAIN3_2_ADDR A:0x6a015868
y.create.l HWIO_WCSS_A_RFIF_TX_GAIN4_2_ADDR A:0x6a015888
y.create.l HWIO_WCSS_A_RFIF_TX_GAIN5_2_ADDR A:0x6a0158a8
y.create.l HWIO_WCSS_A_RFIF_TX_GAIN6_2_ADDR A:0x6a0158c8
y.create.l HWIO_WCSS_A_RFIF_TX_GAIN7_2_ADDR A:0x6a0158e8
y.create.l HWIO_WCSS_A_RFIF_TX_GAIN8_2_ADDR A:0x6a015908
y.create.l HWIO_WCSS_A_RFIF_TX_GAIN9_2_ADDR A:0x6a015928
y.create.l HWIO_WCSS_A_RFIF_TX_GAIN0_3_ADDR A:0x6a01580c
y.create.l HWIO_WCSS_A_RFIF_TX_GAIN1_3_ADDR A:0x6a01582c
y.create.l HWIO_WCSS_A_RFIF_TX_GAIN2_3_ADDR A:0x6a01584c
y.create.l HWIO_WCSS_A_RFIF_TX_GAIN3_3_ADDR A:0x6a01586c
y.create.l HWIO_WCSS_A_RFIF_TX_GAIN4_3_ADDR A:0x6a01588c
y.create.l HWIO_WCSS_A_RFIF_TX_GAIN5_3_ADDR A:0x6a0158ac
y.create.l HWIO_WCSS_A_RFIF_TX_GAIN6_3_ADDR A:0x6a0158cc
y.create.l HWIO_WCSS_A_RFIF_TX_GAIN7_3_ADDR A:0x6a0158ec
y.create.l HWIO_WCSS_A_RFIF_TX_GAIN8_3_ADDR A:0x6a01590c
y.create.l HWIO_WCSS_A_RFIF_TX_GAIN9_3_ADDR A:0x6a01592c
y.create.l HWIO_WCSS_A_RFIF_TX_GAIN0_4_ADDR A:0x6a015810
y.create.l HWIO_WCSS_A_RFIF_TX_GAIN1_4_ADDR A:0x6a015830
y.create.l HWIO_WCSS_A_RFIF_TX_GAIN2_4_ADDR A:0x6a015850
y.create.l HWIO_WCSS_A_RFIF_TX_GAIN3_4_ADDR A:0x6a015870
y.create.l HWIO_WCSS_A_RFIF_TX_GAIN4_4_ADDR A:0x6a015890
y.create.l HWIO_WCSS_A_RFIF_TX_GAIN5_4_ADDR A:0x6a0158b0
y.create.l HWIO_WCSS_A_RFIF_TX_GAIN6_4_ADDR A:0x6a0158d0
y.create.l HWIO_WCSS_A_RFIF_TX_GAIN7_4_ADDR A:0x6a0158f0
y.create.l HWIO_WCSS_A_RFIF_TX_GAIN8_4_ADDR A:0x6a015910
y.create.l HWIO_WCSS_A_RFIF_TX_GAIN9_4_ADDR A:0x6a015930
y.create.l HWIO_WCSS_A_RFIF_TX_GAIN0_5_ADDR A:0x6a015814
y.create.l HWIO_WCSS_A_RFIF_TX_GAIN1_5_ADDR A:0x6a015834
y.create.l HWIO_WCSS_A_RFIF_TX_GAIN2_5_ADDR A:0x6a015854
y.create.l HWIO_WCSS_A_RFIF_TX_GAIN3_5_ADDR A:0x6a015874
y.create.l HWIO_WCSS_A_RFIF_TX_GAIN4_5_ADDR A:0x6a015894
y.create.l HWIO_WCSS_A_RFIF_TX_GAIN5_5_ADDR A:0x6a0158b4
y.create.l HWIO_WCSS_A_RFIF_TX_GAIN6_5_ADDR A:0x6a0158d4
y.create.l HWIO_WCSS_A_RFIF_TX_GAIN7_5_ADDR A:0x6a0158f4
y.create.l HWIO_WCSS_A_RFIF_TX_GAIN8_5_ADDR A:0x6a015914
y.create.l HWIO_WCSS_A_RFIF_TX_GAIN9_5_ADDR A:0x6a015934
y.create.l HWIO_WCSS_A_RPE_MEM_BASE_ADDR_ADDR A:0x6a082400
y.create.l HWIO_WCSS_A_RPE_FULLSTATE_STATIONS_QUEUES_ADDR A:0x6a082404
y.create.l HWIO_WCSS_A_RPE_SM_STUCK_CNT_VALUE_ADDR A:0x6a082408
y.create.l HWIO_WCSS_A_RPE_RPE_CONFIG_ADDR A:0x6a08240c
y.create.l HWIO_WCSS_A_RPE_ROUTING_FLAG_ADDR A:0x6a082410
y.create.l HWIO_WCSS_A_RPE_SW_FLUSH_BITMAP_CACHE_ADDR A:0x6a082414
y.create.l HWIO_WCSS_A_RPE_FULLSTATE_BITMAP_CACHE_DW1_ADDR A:0x6a082418
y.create.l HWIO_WCSS_A_RPE_FULLSTATE_BITMAP_CACHE_DW2_ADDR A:0x6a08241c
y.create.l HWIO_WCSS_A_RPE_FULLSTATE_BITMAP_CACHE_DW3_ADDR A:0x6a082420
y.create.l HWIO_WCSS_A_RPE_STATIONID_QID_4_FULLSTATE_BITMAP_ADDR A:0x6a082424
y.create.l HWIO_WCSS_A_RPE_PARTIALSTATE_BITMAP_CACHE_DW1_ADDR A:0x6a082428
y.create.l HWIO_WCSS_A_RPE_PARTIALSTATE_BITMAP_CACHE_DW2_ADDR A:0x6a08242c
y.create.l HWIO_WCSS_A_RPE_PARTIALSTATE_BITMAP_CACHE_DW3_ADDR A:0x6a082430
y.create.l HWIO_WCSS_A_RPE_STATIONID_QID_4_PARTIALSTATE_BITMAP_ADDR A:0x6a082434
y.create.l HWIO_WCSS_A_RPE_FRAGMENT_RESRC_ENTRY1_DW1_ADDR A:0x6a082438
y.create.l HWIO_WCSS_A_RPE_FRAGMENT_RESRC_ENTRY1_DW2_ADDR A:0x6a08243c
y.create.l HWIO_WCSS_A_RPE_FRAGMENT_RESRC_ENTRY2_DW1_ADDR A:0x6a082440
y.create.l HWIO_WCSS_A_RPE_FRAGMENT_RESRC_ENTRY2_DW2_ADDR A:0x6a082444
y.create.l HWIO_WCSS_A_RPE_ERR_INT_ENABLE_ADDR A:0x6a082478
y.create.l HWIO_WCSS_A_RPE_ERR_INT_STATUS_ADDR A:0x6a08247c
y.create.l HWIO_WCSS_A_RPE_CUR_STATE_BU_DD_ADDR A:0x6a082480
y.create.l HWIO_WCSS_A_RPE_CUR_STATE_RA_RR_ADDR A:0x6a082484
y.create.l HWIO_WCSS_A_RPE_CUR_STATE_DMA_ADDR A:0x6a082488
y.create.l HWIO_WCSS_A_RPE_SEND_PKT_STATS_ADDR A:0x6a08248c
y.create.l HWIO_WCSS_A_RPE_DROP_PKT_STATS_ADDR A:0x6a082490
y.create.l HWIO_WCSS_A_RPE_GET_BMU_FAIL_STATS_ADDR A:0x6a082494
y.create.l HWIO_WCSS_A_RPE_RPE_TESTBUS_LOWER_ADDR A:0x6a082498
y.create.l HWIO_WCSS_A_RPE_RPE_TESTBUS_UPPER_ADDR A:0x6a08249c
y.create.l HWIO_WCSS_A_RPE_RPE_BITMAP_DUPLICATE_CNTR_ADDR A:0x6a082500
y.create.l HWIO_WCSS_A_RPE_RPE_SW_FLUSH_RSRC_ENTRY_ADDR A:0x6a082504
y.create.l HWIO_WCSS_A_RPE_RPE_SW_BLOCK_PKTS_ADDR A:0x6a082508
y.create.l HWIO_WCSS_A_RPE_REORDER_BITMAP_CACHE_DW1_ADDR A:0x6a08250c
y.create.l HWIO_WCSS_A_RPE_REORDER_BITMAP_CACHE_DW2_ADDR A:0x6a082510
y.create.l HWIO_WCSS_A_RPE_REORDER_BITMAP_CACHE_DW3_ADDR A:0x6a082514
y.create.l HWIO_WCSS_A_RPE_SPARE_AND_CLK_GATE_DISABLE_ADDR A:0x6a082550
y.create.l HWIO_WCSS_A_RXACLKCTRL_ROOT_CLK_EN_ADDR A:0x6a016000
y.create.l HWIO_WCSS_A_RXACLKCTRL_APB_BLOCK_CLK_EN_ADDR A:0x6a016004
y.create.l HWIO_WCSS_A_RXACLKCTRL_APB_BLOCK_DYN_CLKG_DISABLE_ADDR A:0x6a016008
y.create.l HWIO_WCSS_A_RXACLKCTRL_DYN_ANTSW_CLK_CTRL_DISABLE_ADDR A:0x6a01600c
y.create.l HWIO_WCSS_A_RXACLKCTRL_MAIN1_FAST_CLK_CTRL_ADDR A:0x6a016010
y.create.l HWIO_WCSS_A_RXCLKCTRL_ROOT_CLK_EN_ADDR A:0x6a016400
y.create.l HWIO_WCSS_A_RXCLKCTRL_APB_BLOCK_CLK_EN_ADDR A:0x6a016404
y.create.l HWIO_WCSS_A_RXCLKCTRL_APB_BLOCK_DYN_CLKG_DISABLE_ADDR A:0x6a016408
y.create.l HWIO_WCSS_A_RXCLKCTRL_APB_BLOCK_DYN_CLKG_DISABLE_AGC_ADDR A:0x6a01640c
y.create.l HWIO_WCSS_A_RXCLKCTRL_APB_SYNC_RESET_ADDR A:0x6a016410
y.create.l HWIO_WCSS_A_RXCLKCTRL_CLK_PHY_MAIN2_3BY4_DIV_BYPASS_ADDR A:0x6a016414
y.create.l HWIO_WCSS_A_RXCLKCTRL_BW_CONFIG_ADDR A:0x6a016418
y.create.l HWIO_WCSS_A_RXCLKCTRL_PHY_VERSION_ADDR A:0x6a016420
y.create.l HWIO_WCSS_A_RXCLKCTRL_FAST_CH_SW_PAGE_SEL_ADDR A:0x6a016424
y.create.l HWIO_WCSS_A_RXCLKCTRL_ADC_FIFO_SYNC_RST_ADDR A:0x6a016428
y.create.l HWIO_WCSS_A_RXP_CONFIG_ADDR A:0x6a080800
y.create.l HWIO_WCSS_A_RXP_MAX_PKTLEN_ADDR A:0x6a080808
y.create.l HWIO_WCSS_A_RXP_SW_BD_REG_ADDR A:0x6a08080c
y.create.l HWIO_WCSS_A_RXP_MPDU_HEADER_START_OFFSET_ADDR A:0x6a080810
y.create.l HWIO_WCSS_A_RXP_SEARCH_ADDR1_PTR_ADDR A:0x6a08082c
y.create.l HWIO_WCSS_A_RXP_SEARCH_ADDR2_PTR_ADDR A:0x6a080830
y.create.l HWIO_WCSS_A_RXP_SEARCH_ADDR3_PTR_ADDR A:0x6a080834
y.create.l HWIO_WCSS_A_RXP_SEARCH_TABLE_CMD_ADDR A:0x6a080838
y.create.l HWIO_WCSS_A_RXP_SEARCH_TABLE_DATA0_ADDR A:0x6a08083c
y.create.l HWIO_WCSS_A_RXP_SEARCH_TABLE_DATA1_ADDR A:0x6a080840
y.create.l HWIO_WCSS_A_RXP_MAX_LEN_AMPDU_ADDR A:0x6a080844
y.create.l HWIO_WCSS_A_RXP_MAX_LEN_MPDU_IN_AMPDU_ADDR A:0x6a080848
y.create.l HWIO_WCSS_A_RXP_DMA_MAX_RSV_PDU_ADDR A:0x6a08084c
y.create.l HWIO_WCSS_A_RXP_DMA_BURST_THRESHOLD_ADDR A:0x6a080850
y.create.l HWIO_WCSS_A_RXP_CLEAR_STATS_ADDR A:0x6a080854
y.create.l HWIO_WCSS_A_RXP_PHY_MPDU_CNT_ADDR A:0x6a080858
y.create.l HWIO_WCSS_A_RXP_PHY_AMPDU_CNT_ADDR A:0x6a08085c
y.create.l HWIO_WCSS_A_RXP_PHY_ABORT_CNT_ADDR A:0x6a080864
y.create.l HWIO_WCSS_A_RXP_PHY_SHUTOFF_CNT_ADDR A:0x6a080868
y.create.l HWIO_WCSS_A_RXP_DLM_FIFO_FULL_CNT_ADDR A:0x6a08086c
y.create.l HWIO_WCSS_A_RXP_DLM_ERR_CNT_ADDR A:0x6a080870
y.create.l HWIO_WCSS_A_RXP_FAIL_FILTER_CNT_ADDR A:0x6a080874
y.create.l HWIO_WCSS_A_RXP_FAIL_MAX_PKTLEN_CNT_ADDR A:0x6a080878
y.create.l HWIO_WCSS_A_RXP_FCS_ERR_CNT_ADDR A:0x6a08087c
y.create.l HWIO_WCSS_A_RXP_DMA_SEND_CNT_ADDR A:0x6a080880
y.create.l HWIO_WCSS_A_RXP_DMA_DROP_CNT_ADDR A:0x6a080884
y.create.l HWIO_WCSS_A_RXP_DMA_GET_BMU_FAIL_CNT_ADDR A:0x6a080888
y.create.l HWIO_WCSS_A_RXP_PROTOCOL_VERSION_FILTER_CNT_ADDR A:0x6a08088c
y.create.l HWIO_WCSS_A_RXP_TYPE_SUBTYPE_FILTER_CNT_ADDR A:0x6a080890
y.create.l HWIO_WCSS_A_RXP_INCORRECT_LENGTH_FILTER_CNT_ADDR A:0x6a080894
y.create.l HWIO_WCSS_A_RXP_ADDR1_BLOCK_FILTER_CNT_ADDR A:0x6a080898
y.create.l HWIO_WCSS_A_RXP_ADDR1_HIT_NO_PASS_CNT_ADDR A:0x6a08089c
y.create.l HWIO_WCSS_A_RXP_ADDR1_DROP_CNT_ADDR A:0x6a0808a0
y.create.l HWIO_WCSS_A_RXP_ADDR2_HIT_NO_PASS_CNT_ADDR A:0x6a0808a4
y.create.l HWIO_WCSS_A_RXP_ADDR2_DROP_CNT_ADDR A:0x6a0808a8
y.create.l HWIO_WCSS_A_RXP_ADDR3_HIT_NO_PASS_CNT_ADDR A:0x6a0808ac
y.create.l HWIO_WCSS_A_RXP_ADDR3_DROP_CNT_ADDR A:0x6a0808b0
y.create.l HWIO_WCSS_A_RXP_MPDU_IN_AMPDU_CNT_ADDR A:0x6a0808b4
y.create.l HWIO_WCSS_A_RXP_PHY_ERR_DROP_CNT_ADDR A:0x6a0808b8
y.create.l HWIO_WCSS_A_RXP_RADAR_DETECT_STATUS_ADDR A:0x6a0808bc
y.create.l HWIO_WCSS_A_RXP_RADAR_DETECT_CONTROL_ADDR A:0x6a0808c0
y.create.l HWIO_WCSS_A_RXP_RADAR_DETECT_LLOGS_ADDR A:0x6a0808c4
y.create.l HWIO_WCSS_A_RXP_RADAR_DETECT_ULOGS_ADDR A:0x6a0808c8
y.create.l HWIO_WCSS_A_RXP_RADAR_DETECT_LOGS_ADDR A:0x6a0808cc
y.create.l HWIO_WCSS_A_RXP_SOFT_PMI_ABORT_ADDR A:0x6a0808d0
y.create.l HWIO_WCSS_A_RXP_START_ERR_CNT_ADDR A:0x6a0808d4
y.create.l HWIO_WCSS_A_RXP_CCA_AND_EXT_TIMEOUT_ADDR A:0x6a0808d8
y.create.l HWIO_WCSS_A_RXP_TIMEOUT_ERROR_CNT_ADDR A:0x6a0808dc
y.create.l HWIO_WCSS_A_RXP_STALL_TIMEOUT_CNT_ADDR A:0x6a0808e0
y.create.l HWIO_WCSS_A_RXP_CFG_FLT_NAV_CONTROL_RESPONSE_REQ_ADDR A:0x6a0808ec
y.create.l HWIO_WCSS_A_RXP_CFG_FLT_TYPE_SUBTYPE_RX_DISABLE0_ADDR A:0x6a0808f0
y.create.l HWIO_WCSS_A_RXP_CFG_FLT_TYPE_SUBTYPE_RX_DISABLE1_ADDR A:0x6a0808f4
y.create.l HWIO_WCSS_A_RXP_DIAG_STATUS_ADDR A:0x6a0808f8
y.create.l HWIO_WCSS_A_RXP_DIAG_TESTBUS_SEL_ADDR A:0x6a0808fc
y.create.l HWIO_WCSS_A_RXP_FRAME_FILTER_CONFIG_ADDR A:0x6a080900
y.create.l HWIO_WCSS_A_RXP_STALL_TIMEOUT_ADDR A:0x6a080a04
y.create.l HWIO_WCSS_A_RXP_MAX_LEN_AMSDU_ADDR A:0x6a080a40
y.create.l HWIO_WCSS_A_RXP_FAIL_MAX_PKTLEN_AMSDU_CNT_ADDR A:0x6a080a44
y.create.l HWIO_WCSS_A_RXP_CONFIG2_ADDR A:0x6a080a50
y.create.l HWIO_WCSS_A_RXP_CONFIG3_ADDR A:0x6a080a54
y.create.l HWIO_WCSS_A_RXP_SEARCH_TABLE_DATA2_ADDR A:0x6a080a58
y.create.l HWIO_WCSS_A_RXP_BEACON_TSF_TIM_EXTRACT_CTRL_ADDR A:0x6a080a5c
y.create.l HWIO_WCSS_A_RXP_TSF_COMPENSATION1_VALUE_ADDR A:0x6a080a60
y.create.l HWIO_WCSS_A_RXP_TSF_COMPENSATION2_VALUE_ADDR A:0x6a080a64
y.create.l HWIO_WCSS_A_RXP_SSID_VALUES_B0_B3_ADDR A:0x6a080a68
y.create.l HWIO_WCSS_A_RXP_SSID_VALUES_B4_B7_ADDR A:0x6a080a6c
y.create.l HWIO_WCSS_A_RXP_SSID_VALUES_B8_B11_ADDR A:0x6a080a70
y.create.l HWIO_WCSS_A_RXP_SSID_VALUES_B12_B15_ADDR A:0x6a080a74
y.create.l HWIO_WCSS_A_RXP_SSID_VALUES_B16_B19_ADDR A:0x6a080a78
y.create.l HWIO_WCSS_A_RXP_SSID_VALUES_B20_B23_ADDR A:0x6a080a7c
y.create.l HWIO_WCSS_A_RXP_SSID_VALUES_B24_B27_ADDR A:0x6a080a80
y.create.l HWIO_WCSS_A_RXP_SSID_VALUES_B28_B31_ADDR A:0x6a080a84
y.create.l HWIO_WCSS_A_RXP_BEACON_ADDR2_LOW_FIELD_ADDR A:0x6a080a88
y.create.l HWIO_WCSS_A_RXP_BEACON_ADDR2_HIGH_FIELD_ADDR A:0x6a080a8c
y.create.l HWIO_WCSS_A_RXP_BEACON_ADDR3_LOW_FIELD_ADDR A:0x6a080a90
y.create.l HWIO_WCSS_A_RXP_BEACON_ADDR3_HIGH_FIELD_ADDR A:0x6a080a94
y.create.l HWIO_WCSS_A_RXP_FLT_DUPL_CNT_ADDR A:0x6a080a98
y.create.l HWIO_WCSS_A_RXP_FLT_RPE_HANDSHAKE_TIMEOUT_CNT_ADDR A:0x6a080a9c
y.create.l HWIO_WCSS_A_RXP_QID_MAPPING0_ADDR A:0x6a080b00
y.create.l HWIO_WCSS_A_RXP_QID_MAPPING1_ADDR A:0x6a080b04
y.create.l HWIO_WCSS_A_RXP_QID_MAPPING2_ADDR A:0x6a080b08
y.create.l HWIO_WCSS_A_RXP_QID_MAPPING3_ADDR A:0x6a080b0c
y.create.l HWIO_WCSS_A_RXP_QID_MAPPING4_ADDR A:0x6a080b10
y.create.l HWIO_WCSS_A_RXP_PUSH_WQ_CTRL_ADDR A:0x6a080b14
y.create.l HWIO_WCSS_A_RXP_PUSH_WQ_CTRL2_ADDR A:0x6a080b18
y.create.l HWIO_WCSS_A_RXP_EXTRA_FRAME_FILTER_CONTROL_ADDR A:0x6a080b1c
y.create.l HWIO_WCSS_A_RXP_RXP_GROUPED_INTERRUPT_ENABLE_ADDR A:0x6a080b20
y.create.l HWIO_WCSS_A_RXP_RXP_GROUPED_INTERRUPT_STATUS_ADDR A:0x6a080b24
y.create.l HWIO_WCSS_A_RXP_DEFAULT_HW_INSERT_DPU_PARAM_ADDR A:0x6a080b28
y.create.l HWIO_WCSS_A_RXP_PSPOLL_NAV_VALUE_ADDR A:0x6a080b44
y.create.l HWIO_WCSS_A_RXP_PMU_INTERFACE_CONTROL_ADDR A:0x6a080b48
y.create.l HWIO_WCSS_A_RXP_RATE_INDEX_HISTORY_ADDR A:0x6a080b50
y.create.l HWIO_WCSS_A_RXP_ADDR2_MISS_INFO_ADDR A:0x6a080b58
y.create.l HWIO_WCSS_A_RXP_ADDR2_MISS_CTRL_ADDR A:0x6a080b5c
y.create.l HWIO_WCSS_A_RXP_EOSP_INT_CONTROL_ADDR A:0x6a080b60
y.create.l HWIO_WCSS_A_RXP_MORE_DATA_CLEAR_INT_CONTROL_ADDR A:0x6a080b64
y.create.l HWIO_WCSS_A_RXP_CONFIG4_ADDR A:0x6a080b6c
y.create.l HWIO_WCSS_A_RXP_BEACON_P2P_CLIENT_ADDR_LOW_FIELD_ADDR A:0x6a080b74
y.create.l HWIO_WCSS_A_RXP_BEACON_P2P_CLIENT_ADDR_HIGH_FIELD_ADDR A:0x6a080b78
y.create.l HWIO_WCSS_A_RXP_P2P_BEACON_PARSE_CONTROL_ADDR A:0x6a080b7c
y.create.l HWIO_WCSS_A_RXP_MORE_DATA_SET_INT_CONTROL_ADDR A:0x6a080b80
y.create.l HWIO_WCSS_A_RXP_RULE1_CNTR_CTRL_ADDR A:0x6a080b84
y.create.l HWIO_WCSS_A_RXP_RULE2_CNTR_CTRL_ADDR A:0x6a080b88
y.create.l HWIO_WCSS_A_RXP_RULE1_CNTR_ADDR A:0x6a080b8c
y.create.l HWIO_WCSS_A_RXP_RULE2_CNTR_ADDR A:0x6a080b90
y.create.l HWIO_WCSS_A_RXP_DROP_DUE_TO_DROP_AT_DMA_CNT_ADDR A:0x6a080b94
y.create.l HWIO_WCSS_A_RXP_RX_TIME_CNTR_ADDR A:0x6a080b98
y.create.l HWIO_WCSS_A_RXP_SPARE_AND_CLKGATE_DIS_ADDR A:0x6a080b9c
y.create.l HWIO_WCSS_A_RXP_NDP_PKT_CNTR_ADDR A:0x6a080ba0
y.create.l HWIO_WCSS_A_RXP_P2P_BEACON_PARSE_CONTROL2_ADDR A:0x6a080ba4
y.create.l HWIO_WCSS_A_RXP_BSS2_BEACON_PARSE_CONTROL_ADDR A:0x6a080ba8
y.create.l HWIO_WCSS_A_RXP_BEACON_BSS2_ADDR_LOW_FIELD_ADDR A:0x6a080bac
y.create.l HWIO_WCSS_A_RXP_BEACON_BSS2_CLIENT_ADDR_HIGH_FIELD_ADDR A:0x6a080bb0
y.create.l HWIO_WCSS_A_RXP_RXP_GROUPED2_INTERRUPT_ENABLE_ADDR A:0x6a080bb4
y.create.l HWIO_WCSS_A_RXP_RXP_GROUPED2_INTERRUPT_STATUS_ADDR A:0x6a080bb8
y.create.l HWIO_WCSS_A_RXP_RXP_QBOOST_CONTROL_ADDR A:0x6a080bbc
y.create.l HWIO_WCSS_A_RXP_RXP_P2P_CHANNELSWITCH_BODY_ADDR A:0x6a080bc0
y.create.l HWIO_WCSS_A_RXP_RXP_BSS_CHANNELSWITCH_BODY_ADDR A:0x6a080bc4
y.create.l HWIO_WCSS_A_RXP_RXP_BSS2_CHANNELSWITCH_BODY_ADDR A:0x6a080bc8
y.create.l HWIO_WCSS_A_RXP_RXP_P2P_QUIETIE_LSBYTES_ADDR A:0x6a080bcc
y.create.l HWIO_WCSS_A_RXP_RXP_BSS_QUIETIE_LSBYTES_ADDR A:0x6a080bd0
y.create.l HWIO_WCSS_A_RXP_RXP_BSS2_QUIETIE_LSBYTES_ADDR A:0x6a080bd4
y.create.l HWIO_WCSS_A_RXP_RXP_P2P_QUIETIE_MSBYTES_ADDR A:0x6a080bd8
y.create.l HWIO_WCSS_A_RXP_RXP_BSS_QUIETIE_MSBYTES_ADDR A:0x6a080bdc
y.create.l HWIO_WCSS_A_RXP_RXP_BSS2_QUIETIE_MSBYTES_ADDR A:0x6a080be0
y.create.l HWIO_WCSS_A_TACTL_CFG_ADDR A:0x6a012400
y.create.l HWIO_WCSS_A_TACTL_SCR_CONFIG_ADDR A:0x6a012404
y.create.l HWIO_WCSS_A_TACTL_TATMUX_CONFIG_ADDR A:0x6a012408
y.create.l HWIO_WCSS_A_TACTL_SCALE_20_ADDR A:0x6a01240c
y.create.l HWIO_WCSS_A_TACTL_SCALE_40_ADDR A:0x6a012410
y.create.l HWIO_WCSS_A_TACTL_SCALE_80_ADDR A:0x6a012414
y.create.l HWIO_WCSS_A_TACTL_CYC_DELAY_11AC_ADDR A:0x6a012418
y.create.l HWIO_WCSS_A_TACTL_DOT11AC_SERVICE_OVERRIDE_ADDR A:0x6a01241c
y.create.l HWIO_WCSS_A_TACTL_DOT11AC_APB_SERVICE_ADDR A:0x6a012420
y.create.l HWIO_WCSS_A_TACTL_DOT11AC_MU_MIMO_NSTS_OVERRIDE_ADDR A:0x6a012424
y.create.l HWIO_WCSS_A_TACTL_CTRL_STATE_ADDR A:0x6a012428
y.create.l HWIO_WCSS_A_TACTL_PKT_REQ_COUNT_ADDR A:0x6a01242c
y.create.l HWIO_WCSS_A_TACTL_TAHDR_SYM_COUNT_ADDR A:0x6a012430
y.create.l HWIO_WCSS_A_TACTL_TAQAM_SYM_COUNT_ADDR A:0x6a012434
y.create.l HWIO_WCSS_A_TACTL_LAST_SYM_PARAMS_ADDR A:0x6a012438
y.create.l HWIO_WCSS_A_TACTL_QAM_NSYMS_ADDR A:0x6a01243c
y.create.l HWIO_WCSS_A_TACTL_NPKTS_ADDR A:0x6a012440
y.create.l HWIO_WCSS_A_TACTL_SCR_LFSR_ADDR A:0x6a012444
y.create.l HWIO_WCSS_A_TACTL_ALARMS_ADDR A:0x6a012448
y.create.l HWIO_WCSS_A_TACTL_RESET_ALARMS_ADDR A:0x6a01244c
y.create.l HWIO_WCSS_A_TACTL_LAST_MU_PARAMS_ADDR A:0x6a012450
y.create.l HWIO_WCSS_A_TACTL_MU_PKT_ADDR A:0x6a012454
y.create.l HWIO_WCSS_A_TACTL_DISABLE_MAC_LSIG_ADDR A:0x6a012458
y.create.l HWIO_WCSS_A_TAQAM_SCALE_BPSK_ADDR A:0x6a012c00
y.create.l HWIO_WCSS_A_TAQAM_SCALE_QPSK_ADDR A:0x6a012c08
y.create.l HWIO_WCSS_A_TAQAM_SCALE_QAM16_ADDR A:0x6a012c0c
y.create.l HWIO_WCSS_A_TAQAM_SCALE_QAM64_ADDR A:0x6a012c10
y.create.l HWIO_WCSS_A_TAQAM_SCALE_QAM256_ADDR A:0x6a012c14
y.create.l HWIO_WCSS_A_TAQAM_SCALE_LEGACY20_ADDR A:0x6a012c18
y.create.l HWIO_WCSS_A_TAQAM_SCALE_LEGACY40_ADDR A:0x6a012c1c
y.create.l HWIO_WCSS_A_TAQAM_SCALE_LEGACY80_ADDR A:0x6a012c20
y.create.l HWIO_WCSS_A_TAQAM_SCALE_HT20_ADDR A:0x6a012c24
y.create.l HWIO_WCSS_A_TAQAM_SCALE_HT40_ADDR A:0x6a012c28
y.create.l HWIO_WCSS_A_TAQAM_SCALE_HT80_ADDR A:0x6a012c2c
y.create.l HWIO_WCSS_A_TAQAM_AC_ADDR A:0x6a012c30
y.create.l HWIO_WCSS_A_TBAPB_CRC16_CTRL_ADDR A:0x6a012800
y.create.l HWIO_WCSS_A_TBAPB_SCRAMBLE_CTRL_ADDR A:0x6a012804
y.create.l HWIO_WCSS_A_TBAPB_TXB_DEBUG_ADDR A:0x6a012808
y.create.l HWIO_WCSS_A_TBAPB_LINEAR_DELAY_ANT1_ADDR A:0x6a01280c
y.create.l HWIO_WCSS_A_TBAPB_LINEAR_DELAY_ANT2_ADDR A:0x6a012810
y.create.l HWIO_WCSS_A_TBAPB_LINEAR_DELAY_ANT3_ADDR A:0x6a012814
y.create.l HWIO_WCSS_A_TDC_TDCSYM_IN_ADDR A:0x6a014c00
y.create.l HWIO_WCSS_A_TDC_TDCSYM_OUT_ADDR A:0x6a014c04
y.create.l HWIO_WCSS_A_TDC_TDCPKT_IN_ADDR A:0x6a014c08
y.create.l HWIO_WCSS_A_TDC_CWDET_COUNT_ADDR A:0x6a014c0c
y.create.l HWIO_WCSS_A_TDC_CWDET_STATUS_ADDR A:0x6a014c10
y.create.l HWIO_WCSS_A_TDC_CWDET_OVERRIDE_ADDR A:0x6a014c14
y.create.l HWIO_WCSS_A_TDC_CWDET_TRIGGER_ADDR A:0x6a014c18
y.create.l HWIO_WCSS_A_TDC_APB_GAIN_THRESH_LLP64_1RX_ADDR A:0x6a014c1c
y.create.l HWIO_WCSS_A_TDC_APB_GAIN_THRESH_LLP128_1RX_ADDR A:0x6a014c20
y.create.l HWIO_WCSS_A_TDC_APB_GAIN_THRESH_HTLTF64_1RX_ADDR A:0x6a014c24
y.create.l HWIO_WCSS_A_TDC_APB_GAIN_THRESH_HTLTF128_1RX_ADDR A:0x6a014c28
y.create.l HWIO_WCSS_A_TDC_APB_GAIN_THRESH_LLP256_1RX_ADDR A:0x6a014c2c
y.create.l HWIO_WCSS_A_TDC_APB_GAIN_THRESH_VHTLTF256_1RX_ADDR A:0x6a014c30
y.create.l HWIO_WCSS_A_TDC_RAM_OVERFLOW_ADDR A:0x6a014c34
y.create.l HWIO_WCSS_A_TPC_TXPWR_OVERRIDE_11A0_ADDR A:0x6a010000
y.create.l HWIO_WCSS_A_TPC_TXPWR_OVERRIDE_11B0_ADDR A:0x6a010004
y.create.l HWIO_WCSS_A_TPC_TXPWR_ENABLE_ADDR A:0x6a010008
y.create.l HWIO_WCSS_A_TPC_ADC_CTRL_GET_ADC_ADDR A:0x6a01000c
y.create.l HWIO_WCSS_A_TPC_ADC_STATUS_ADDR A:0x6a010010
y.create.l HWIO_WCSS_A_TPC_MAN_TXPWR_ADDR A:0x6a010014
y.create.l HWIO_WCSS_A_TPC_MAX_RF_GAIN_ADDR A:0x6a010018
y.create.l HWIO_WCSS_A_TPC_MIN_RF_GAIN_ADDR A:0x6a01001c
y.create.l HWIO_WCSS_A_TPC_MAX_DIGITAL_GAIN_ADDR A:0x6a010020
y.create.l HWIO_WCSS_A_TPC_MID_DIGITAL_GAIN_ADDR A:0x6a010024
y.create.l HWIO_WCSS_A_TPC_MIN_DIGITAL_GAIN_ADDR A:0x6a010028
y.create.l HWIO_WCSS_A_TPC_RC_DELAY_ADDR A:0x6a010030
y.create.l HWIO_WCSS_A_TPC_SENSED_PWR0_ADDR A:0x6a010034
y.create.l HWIO_WCSS_A_TPC_ADCTIMEOUT_ADDR A:0x6a010038
y.create.l HWIO_WCSS_A_TPC_APBACCESS_ADDR A:0x6a01003c
y.create.l HWIO_WCSS_A_TPC_PTADC_FSM_RST_ADDR A:0x6a010040
y.create.l HWIO_WCSS_A_TPC_PDADC_RANGE_ADDR A:0x6a010048
y.create.l HWIO_WCSS_A_TPC_PDADC_OFFSET_ADDR A:0x6a01004c
y.create.l HWIO_WCSS_A_TPC_GAIN_OFFSET1_ADDR A:0x6a010050
y.create.l HWIO_WCSS_A_TPC_GAIN_OFFSET2_ADDR A:0x6a010054
y.create.l HWIO_WCSS_A_TPC_DEMANDED_PWR_RANGE_ADDR A:0x6a010058
y.create.l HWIO_WCSS_A_TPC_LAST_DEMANDED_PWR_ADDR A:0x6a01005c
y.create.l HWIO_WCSS_A_TPC_POWERDET0_RAM0_ADDR A:0x6a010800
y.create.l HWIO_WCSS_A_TPC_POWERDET0_RAM1_ADDR A:0x6a010804
y.create.l HWIO_WCSS_A_TPC_POWERDET0_RAM2_ADDR A:0x6a010808
y.create.l HWIO_WCSS_A_TPC_POWERDET0_RAM3_ADDR A:0x6a01080c
y.create.l HWIO_WCSS_A_TPC_POWERDET0_RAM4_ADDR A:0x6a010810
y.create.l HWIO_WCSS_A_TPC_POWERDET0_RAM5_ADDR A:0x6a010814
y.create.l HWIO_WCSS_A_TPC_POWERDET0_RAM6_ADDR A:0x6a010818
y.create.l HWIO_WCSS_A_TPC_POWERDET0_RAM7_ADDR A:0x6a01081c
y.create.l HWIO_WCSS_A_TPC_POWERDET0_RAM8_ADDR A:0x6a010820
y.create.l HWIO_WCSS_A_TPC_POWERDET0_RAM9_ADDR A:0x6a010824
y.create.l HWIO_WCSS_A_TPC_RF_GAIN_LUT00_ADDR A:0x6a010c00
y.create.l HWIO_WCSS_A_TPC_RF_GAIN_LUT01_ADDR A:0x6a010c04
y.create.l HWIO_WCSS_A_TPC_RF_GAIN_LUT02_ADDR A:0x6a010c08
y.create.l HWIO_WCSS_A_TPC_RF_GAIN_LUT03_ADDR A:0x6a010c0c
y.create.l HWIO_WCSS_A_TPC_RF_GAIN_LUT04_ADDR A:0x6a010c10
y.create.l HWIO_WCSS_A_TPC_RF_GAIN_LUT05_ADDR A:0x6a010c14
y.create.l HWIO_WCSS_A_TPC_RF_GAIN_LUT06_ADDR A:0x6a010c18
y.create.l HWIO_WCSS_A_TPC_RF_GAIN_LUT07_ADDR A:0x6a010c1c
y.create.l HWIO_WCSS_A_TPC_RF_GAIN_LUT08_ADDR A:0x6a010c20
y.create.l HWIO_WCSS_A_TPC_RF_GAIN_LUT09_ADDR A:0x6a010c24
y.create.l HWIO_WCSS_A_TPC_DIGITAL_GAIN_LUT00_ADDR A:0x6a010c80
y.create.l HWIO_WCSS_A_TPC_DIGITAL_GAIN_LUT01_ADDR A:0x6a010c84
y.create.l HWIO_WCSS_A_TPC_DIGITAL_GAIN_LUT02_ADDR A:0x6a010c88
y.create.l HWIO_WCSS_A_TPC_DIGITAL_GAIN_LUT03_ADDR A:0x6a010c8c
y.create.l HWIO_WCSS_A_TPC_DIGITAL_GAIN_LUT04_ADDR A:0x6a010c90
y.create.l HWIO_WCSS_A_TPC_DIGITAL_GAIN_LUT05_ADDR A:0x6a010c94
y.create.l HWIO_WCSS_A_TPC_DIGITAL_GAIN_LUT06_ADDR A:0x6a010c98
y.create.l HWIO_WCSS_A_TPC_DIGITAL_GAIN_LUT07_ADDR A:0x6a010c9c
y.create.l HWIO_WCSS_A_TPC_DIGITAL_GAIN_LUT08_ADDR A:0x6a010ca0
y.create.l HWIO_WCSS_A_TPC_DIGITAL_GAIN_LUT09_ADDR A:0x6a010ca4
y.create.l HWIO_WCSS_A_TPE_EDCF_TXOP_0_1_ADDR A:0x6a082000
y.create.l HWIO_WCSS_A_TPE_EDCF_TXOP_2_3_ADDR A:0x6a082004
y.create.l HWIO_WCSS_A_TPE_EDCF_TXOP_4_5_ADDR A:0x6a082008
y.create.l HWIO_WCSS_A_TPE_EDCF_TXOP_6_7_ADDR A:0x6a08200c
y.create.l HWIO_WCSS_A_TPE_SW_TEMPLATE_BASE_ADDR_ADDR A:0x6a082010
y.create.l HWIO_WCSS_A_TPE_SW_TPE_HW_CONTROL_REG_ADDR A:0x6a082014
y.create.l HWIO_WCSS_A_TPE_SW_SOFTWARE_TX_CONTROL_REG1_ADDR A:0x6a082018
y.create.l HWIO_WCSS_A_TPE_SW_SOFTWARE_TX_ADDRESS_ADDR A:0x6a08201c
y.create.l HWIO_WCSS_A_TPE_SW_MAX_BYTES_AND_TX_TIME_IN_AMPDU_ADDR A:0x6a082020
y.create.l HWIO_WCSS_A_TPE_SW_MAX_MPDUS_IN_AMPDU_AND_MISC_ADDR A:0x6a082024
y.create.l HWIO_WCSS_A_TPE_SW_STA_DESCR_ADDR_ADDR A:0x6a082028
y.create.l HWIO_WCSS_A_TPE_SW_TPE_TEST_AND_MISC_ADDR A:0x6a082030
y.create.l HWIO_WCSS_A_TPE_SW_PM_ADDR A:0x6a082034
y.create.l HWIO_WCSS_A_TPE_SW_TPE_TEST_BUS_LOWER_ADDR A:0x6a082038
y.create.l HWIO_WCSS_A_TPE_SW_11G_CTRL_INDEX_OFFSET_ADDR A:0x6a08203c
y.create.l HWIO_WCSS_A_TPE_RATE_TABLE_SRAM_CONTROL_ADDR A:0x6a082040
y.create.l HWIO_WCSS_A_TPE_RATE_TABLE_SRAM_CONTROL2_ADDR A:0x6a082044
y.create.l HWIO_WCSS_A_TPE_SW_BEACON_BASE_ADDR_ADDR A:0x6a082050
y.create.l HWIO_WCSS_A_TPE_SW_BEACON_MAX_SIZE_MISC_ADDR A:0x6a082054
y.create.l HWIO_WCSS_A_TPE_SW_GLOBAL_CF_END_DATA_POWER_TEMPLATE_ADDR A:0x6a082058
y.create.l HWIO_WCSS_A_TPE_TPE_BMU_INTERFACE_CNTS_ADDR A:0x6a082080
y.create.l HWIO_WCSS_A_TPE_RXP_TPE_INTERFACE_CNTS_ADDR A:0x6a082084
y.create.l HWIO_WCSS_A_TPE_MTU_TPE_INTERFACE_CNTS_ADDR A:0x6a082088
y.create.l HWIO_WCSS_A_TPE_RPE_TPE_INTERFACE_CNTS_ADDR A:0x6a08208c
y.create.l HWIO_WCSS_A_TPE_ERROR_INT_CNTS_ADDR A:0x6a082090
y.create.l HWIO_WCSS_A_TPE_UNICAST_BYTES_LOWER_ADDR A:0x6a0820c0
y.create.l HWIO_WCSS_A_TPE_UNICAST_BYTES_UPPER_ADDR A:0x6a0820c4
y.create.l HWIO_WCSS_A_TPE_MULTICAST_BYTES_LOWER_ADDR A:0x6a0820c8
y.create.l HWIO_WCSS_A_TPE_MULTICAST_BYTES_UPPER_ADDR A:0x6a0820cc
y.create.l HWIO_WCSS_A_TPE_BROADCAST_BYTES_LOWER_ADDR A:0x6a0820d0
y.create.l HWIO_WCSS_A_TPE_BROADCAST_BYTES_UPPER_ADDR A:0x6a0820d4
y.create.l HWIO_WCSS_A_TPE_STATISTIC_COUNTERS_CNTL_ADDR A:0x6a082100
y.create.l HWIO_WCSS_A_TPE_TPE_STATUS_REG_LOWER_ADDR A:0x6a082104
y.create.l HWIO_WCSS_A_TPE_TPE_STATUS_REG_UPPER_ADDR A:0x6a082108
y.create.l HWIO_WCSS_A_TPE_GOT_ACK_FOR_BACK_INFO_REG_ADDR A:0x6a082110
y.create.l HWIO_WCSS_A_TPE_SW_DELAY_WAIT_CMD_CNT_REG_ADDR A:0x6a082118
y.create.l HWIO_WCSS_A_TPE_SW_MEDIUM_TIME_USED_AC0_ADDR A:0x6a08211c
y.create.l HWIO_WCSS_A_TPE_SW_MEDIUM_TIME_USED_AC1_ADDR A:0x6a082120
y.create.l HWIO_WCSS_A_TPE_SW_MEDIUM_TIME_USED_AC2_ADDR A:0x6a082124
y.create.l HWIO_WCSS_A_TPE_SW_MEDIUM_TIME_USED_AC3_ADDR A:0x6a082128
y.create.l HWIO_WCSS_A_TPE_SW_MEDIUM_TIME_THR_AC0_AC1_ADDR A:0x6a08212c
y.create.l HWIO_WCSS_A_TPE_SW_MEDIUM_TIME_THR_AC2_AC3_ADDR A:0x6a082130
y.create.l HWIO_WCSS_A_TPE_SW_ADMISSION_CONTROL_CONTROL_REG_ADDR A:0x6a082134
y.create.l HWIO_WCSS_A_TPE_SW_LIFE_TIME_DROP_CNT_ADDR A:0x6a08213c
y.create.l HWIO_WCSS_A_TPE_TPE_MCU_BD_BASED_TX_INT_FEEDBACK_ADDR A:0x6a082140
y.create.l HWIO_WCSS_A_TPE_TPE_MCU_BD_BASED_TX_INT_FEEDBACK_1_ADDR A:0x6a082144
y.create.l HWIO_WCSS_A_TPE_WRONG_BA_SSN_TID_FEEDBACK_ADDR A:0x6a082148
y.create.l HWIO_WCSS_A_TPE_SW_CAPPED_POWER_CONTROL_ADDR A:0x6a08214c
y.create.l HWIO_WCSS_A_TPE_SW_ACK_TO_DUE_TO_BTC_COUNT_ADDR A:0x6a082150
y.create.l HWIO_WCSS_A_TPE_SW_LOW_PRIORITY_BT_REJECTED_COUNT_ADDR A:0x6a082154
y.create.l HWIO_WCSS_A_TPE_SW_TERMINATE_CURRENT_TX_VALID_ADDR A:0x6a082158
y.create.l HWIO_WCSS_A_TPE_RTT_REGISTER_ADDR A:0x6a08215c
y.create.l HWIO_WCSS_A_TPE_BEAMFORM_CTRL_ADDR A:0x6a082160
y.create.l HWIO_WCSS_A_TPE_CFG_CSI_ADDR_ADDR A:0x6a082164
y.create.l HWIO_WCSS_A_TPE_INTERRUPT_ENABLE_ADDR A:0x6a082168
y.create.l HWIO_WCSS_A_TPE_INTERRUPT_STATUS_ADDR A:0x6a08216c
y.create.l HWIO_WCSS_A_TPE_BEAMFORM_STATUS_ADDR A:0x6a082170
y.create.l HWIO_WCSS_A_TPE_CALIBRATION_CNT_ADDR A:0x6a082174
y.create.l HWIO_WCSS_A_TPE_BEAMFORM_CNT_ADDR A:0x6a082178
y.create.l HWIO_WCSS_A_TPE_SW_PM_2_ADDR A:0x6a08217c
y.create.l HWIO_WCSS_A_TPE_SW_11AC_PADDING_ADDR A:0x6a082198
y.create.l HWIO_WCSS_A_TPE_NDP_BEAMFORM_CTRL_ADDR A:0x6a0821b0
y.create.l HWIO_WCSS_A_TPE_BEAMFORM_QOSNULL_NDP_CNT_ADDR A:0x6a0821b4
y.create.l HWIO_WCSS_A_TPE_CXM_CTRL_ADDR A:0x6a0821b8
y.create.l HWIO_WCSS_A_TPE_SW_11AC_CTRL_ADDR A:0x6a0821bc
y.create.l HWIO_WCSS_A_TPE_SW_NONHT_BW_CTRL_ADDR A:0x6a0821e4
y.create.l HWIO_WCSS_A_TPE_SW_GLOBAL_CF_END_DATA_POWER_TEMPLATE_40MHZ_ADDR A:0x6a0821e8
y.create.l HWIO_WCSS_A_TPE_SW_GLOBAL_CF_END_DATA_POWER_TEMPLATE_80MHZ_ADDR A:0x6a0821ec
y.create.l HWIO_WCSS_A_TPE_SW_WARMUP_DELAY_ADDR A:0x6a0821f0
y.create.l HWIO_WCSS_A_TPE_MAIN_MPROC_REQ_CNT_ADDR A:0x6a0821f4
y.create.l HWIO_WCSS_A_TPE_SW_11AC_BEAMFORM_CTRL_ADDR A:0x6a0821f8
y.create.l HWIO_WCSS_A_TPE_SW_11AC_CNT1_ADDR A:0x6a0821fc
y.create.l HWIO_WCSS_A_TPE_SW_11AC_CNT2_ADDR A:0x6a0821ac
y.create.l HWIO_WCSS_A_TPE_SW_11AC_VHTCB_RATE_ADDR A:0x6a0821a8
y.create.l HWIO_WCSS_A_TPE_SW_VHTCB_ADDR2_0_LO_ADDR A:0x6a0821a0
y.create.l HWIO_WCSS_A_TPE_SW_VHTCB_ADDR2_0_HI_ADDR A:0x6a0821a4
y.create.l HWIO_WCSS_A_TPE_SW_VHTCB_ADDR2_1_LO_ADDR A:0x6a0821c0
y.create.l HWIO_WCSS_A_TPE_SW_VHTCB_ADDR2_1_HI_ADDR A:0x6a0821c4
y.create.l HWIO_WCSS_A_TPE_SW_VHTCB_ADDR2_LOOKUP_ADDR A:0x6a0821c8
y.create.l HWIO_WCSS_A_TPE_SW_RTT3_ABSOLUTE_ADDR A:0x6a0821cc
y.create.l HWIO_WCSS_A_TPE_SW_RTT3_DELTA_ADDR A:0x6a0821d0
y.create.l HWIO_WCSS_A_TPE_SW_RTT3_CTRL_ADDR A:0x6a0821d4
y.create.l HWIO_WCSS_A_TPE_SW_RTT3_CTRL2_ADDR A:0x6a0821d8
y.create.l HWIO_WCSS_A_TPE_SW_11AF_CTRL_ADDR A:0x6a0821dc
y.create.l HWIO_WCSS_A_TPE_SW_QBOOST_CTRL_ADDR A:0x6a0821e0
y.create.l HWIO_WCSS_A_TXCLKCTRL_ROOT_CLK_EN_ADDR A:0x6a013000
y.create.l HWIO_WCSS_A_TXCLKCTRL_APB_BLOCK_CLK_EN_ADDR A:0x6a013004
y.create.l HWIO_WCSS_A_TXCLKCTRL_APB_BLOCK_DYN_CLKG_DISABLE_ADDR A:0x6a013008
y.create.l HWIO_WCSS_A_TXCTL_FIR_MODE_ADDR A:0x6a012000
y.create.l HWIO_WCSS_A_TXCTL_PA_GUARD_ADDR A:0x6a012004
y.create.l HWIO_WCSS_A_TXCTL_RAMP_UP_11A_ADDR A:0x6a012008
y.create.l HWIO_WCSS_A_TXCTL_RAMP_UP_11B_ADDR A:0x6a01200c
y.create.l HWIO_WCSS_A_TXCTL_RAMP_DOWN_ADDR A:0x6a012010
y.create.l HWIO_WCSS_A_TXCTL_TESTMUX_SELECT_ADDR A:0x6a012014
y.create.l HWIO_WCSS_A_TXCTL_DAC_CONTROL_ADDR A:0x6a012018
y.create.l HWIO_WCSS_A_TXCTL_DAC_STDBY_ADDR A:0x6a01201c
y.create.l HWIO_WCSS_A_TXCTL_PLCP_OVERRIDE_ADDR A:0x6a012020
y.create.l HWIO_WCSS_A_TXCTL_FSHIFT_ADDR A:0x6a012024
y.create.l HWIO_WCSS_A_TXCTL_SOFTRESET_ADDR A:0x6a012028
y.create.l HWIO_WCSS_A_TXCTL_WATCHDOG_START_ADDR A:0x6a01202c
y.create.l HWIO_WCSS_A_TXCTL_WATCHDOG_RFWARM_ADDR A:0x6a012030
y.create.l HWIO_WCSS_A_TXCTL_WATCHDOG_PAGUARD_ADDR A:0x6a012034
y.create.l HWIO_WCSS_A_TXCTL_WATCHDOG_RAMPUP_ADDR A:0x6a012038
y.create.l HWIO_WCSS_A_TXCTL_WATCHDOG_TX_ADDR A:0x6a01203c
y.create.l HWIO_WCSS_A_TXCTL_WATCHDOG_SHUTOFF_ADDR A:0x6a012040
y.create.l HWIO_WCSS_A_TXCTL_WATCHDOG_TPC_ADDR A:0x6a012044
y.create.l HWIO_WCSS_A_TXCTL_MAX_TXBUSY_ADDR A:0x6a012048
y.create.l HWIO_WCSS_A_TXCTL_MAX_TXENB_ADDR A:0x6a01204c
y.create.l HWIO_WCSS_A_TXCTL_TXBUSY_ALARM_ADDR A:0x6a012050
y.create.l HWIO_WCSS_A_TXCTL_TXEN_ALARM_ADDR A:0x6a012054
y.create.l HWIO_WCSS_A_TXCTL_TXCTL_STATE_ADDR A:0x6a012058
y.create.l HWIO_WCSS_A_TXCTL_LAST_PKT_PARAMS1_ADDR A:0x6a01205c
y.create.l HWIO_WCSS_A_TXCTL_LAST_PKT_PACKET_LENGTH_ADDR A:0x6a012060
y.create.l HWIO_WCSS_A_TXCTL_LAST_PKT_LSIG_LENGTH_ADDR A:0x6a012064
y.create.l HWIO_WCSS_A_TXCTL_LAST_TX_POWER_ADDR A:0x6a012068
y.create.l HWIO_WCSS_A_TXCTL_WATCHDOG_ALARM_ADDR A:0x6a01206c
y.create.l HWIO_WCSS_A_TXCTL_PKT_INVALID_ALARM_ADDR A:0x6a012070
y.create.l HWIO_WCSS_A_TXCTL_TXA_ABORT_ALARM_ADDR A:0x6a012074
y.create.l HWIO_WCSS_A_TXCTL_LEGACY_PKTS_ADDR A:0x6a012078
y.create.l HWIO_WCSS_A_TXCTL_GF_SIMO_20_PKTS_ADDR A:0x6a01207c
y.create.l HWIO_WCSS_A_TXCTL_GF_SIMO_40_PKTS_ADDR A:0x6a012080
y.create.l HWIO_WCSS_A_TXCTL_MM_SIMO_20_PKTS_ADDR A:0x6a012084
y.create.l HWIO_WCSS_A_TXCTL_MM_SIMO_40_PKTS_ADDR A:0x6a012088
y.create.l HWIO_WCSS_A_TXCTL_AC_SIMO_20_PKTS_ADDR A:0x6a01208c
y.create.l HWIO_WCSS_A_TXCTL_AC_SIMO_40_PKTS_ADDR A:0x6a012090
y.create.l HWIO_WCSS_A_TXCTL_AC_SIMO_80_PKTS_ADDR A:0x6a012094
y.create.l HWIO_WCSS_A_TXCTL_TXB_SHORT_PKTS_ADDR A:0x6a012098
y.create.l HWIO_WCSS_A_TXCTL_TXB_LONG_PKTS_ADDR A:0x6a01209c
y.create.l HWIO_WCSS_A_TXCTL_TXFIR_DONE_ADDR A:0x6a0120a0
y.create.l HWIO_WCSS_A_TXCTL_MISSING_WARMUP_ADDR A:0x6a0120a4
y.create.l HWIO_WCSS_A_TXCTL_ALARMS_ADDR A:0x6a0120a8
y.create.l HWIO_WCSS_A_TXCTL_RESET_ALARMS_ADDR A:0x6a0120ac
y.create.l HWIO_WCSS_A_TXFIR_CFG_ADDR A:0x6a018000
y.create.l HWIO_WCSS_A_TXFIR_LOLEAKAGE_SHIFT_ADDR A:0x6a018004
y.create.l HWIO_WCSS_A_TXFIR_COEFF_QUARTER_0_ADDR A:0x6a01800c
y.create.l HWIO_WCSS_A_TXFIR_COEFF_QUARTER_1_ADDR A:0x6a018010
y.create.l HWIO_WCSS_A_TXFIR_COEFF_QUARTER_2_ADDR A:0x6a018014
y.create.l HWIO_WCSS_A_TXFIR_COEFF_QUARTER_3_ADDR A:0x6a018018
y.create.l HWIO_WCSS_A_TXFIR_COEFF_QUARTER_4_ADDR A:0x6a01801c
y.create.l HWIO_WCSS_A_TXFIR_COEFF_QUARTER_5_ADDR A:0x6a018020
y.create.l HWIO_WCSS_A_TXFIR_COEFF_QUARTER_6_ADDR A:0x6a018024
y.create.l HWIO_WCSS_A_TXFIR_COEFF_QUARTER_7_ADDR A:0x6a018028
y.create.l HWIO_WCSS_A_TXFIR_COEFF_QUARTER_8_ADDR A:0x6a01802c
y.create.l HWIO_WCSS_A_TXFIR_COEFF_QUARTER_9_ADDR A:0x6a018030
y.create.l HWIO_WCSS_A_TXFIR_COEFF_QUARTER_10_ADDR A:0x6a018034
y.create.l HWIO_WCSS_A_TXFIR_COEFF_QUARTER_11_ADDR A:0x6a018038
y.create.l HWIO_WCSS_A_TXFIR_COEFF_QUARTER_12_ADDR A:0x6a01803c
y.create.l HWIO_WCSS_A_TXFIR_COEFF_QUARTER_13_ADDR A:0x6a018040
y.create.l HWIO_WCSS_A_TXFIR_COEFF_QUARTER_14_ADDR A:0x6a018044
y.create.l HWIO_WCSS_A_TXFIR_COEFF_QUARTER_15_ADDR A:0x6a018048
y.create.l HWIO_WCSS_A_TXFIR_COEFF_QUARTER_16_ADDR A:0x6a01804c
y.create.l HWIO_WCSS_A_TXFIR_COEFF_QUARTER_17_ADDR A:0x6a018050
y.create.l HWIO_WCSS_A_TXFIR_COEFF_QUARTER_18_ADDR A:0x6a018054
y.create.l HWIO_WCSS_A_TXFIR_COEFF_QUARTER_19_ADDR A:0x6a018058
y.create.l HWIO_WCSS_A_TXFIR_COEFF_QUARTER_20_ADDR A:0x6a01805c
y.create.l HWIO_WCSS_A_TXFIR_COEFF_QUARTER_21_ADDR A:0x6a018060
y.create.l HWIO_WCSS_A_TXFIR_COEFF_QUARTER_22_ADDR A:0x6a018064
y.create.l HWIO_WCSS_A_TXFIR_COEFF_QUARTER_23_ADDR A:0x6a018068
y.create.l HWIO_WCSS_A_TXFIR_COEFF_QUARTER_24_ADDR A:0x6a01806c
y.create.l HWIO_WCSS_A_TXFIR_COEFF_QUARTER_25_ADDR A:0x6a018070
y.create.l HWIO_WCSS_A_TXFIR_COEFF_QUARTER_26_ADDR A:0x6a018074
y.create.l HWIO_WCSS_A_TXFIR_COEFF_QUARTER_27_ADDR A:0x6a018078
y.create.l HWIO_WCSS_A_TXFIR_COEFF_QUARTER_28_ADDR A:0x6a01807c
y.create.l HWIO_WCSS_A_TXFIR_COEFF_QUARTER_29_ADDR A:0x6a018080
y.create.l HWIO_WCSS_A_TXFIR_COEFF_QUARTER_30_ADDR A:0x6a018084
y.create.l HWIO_WCSS_A_TXFIR_COEFF_QUARTER_31_ADDR A:0x6a018088
y.create.l HWIO_WCSS_A_TXFIR_COEFF_QUARTER_32_ADDR A:0x6a01808c
y.create.l HWIO_WCSS_A_TXFIR_COEFF_QUARTER_33_ADDR A:0x6a018090
y.create.l HWIO_WCSS_A_TXFIR_COEFF_QUARTER_34_ADDR A:0x6a018094
y.create.l HWIO_WCSS_A_TXFIR_COEFF_QUARTER_35_ADDR A:0x6a018098
y.create.l HWIO_WCSS_A_TXFIR_COEFF_QUARTER_36_ADDR A:0x6a01809c
y.create.l HWIO_WCSS_A_TXFIR_COEFF_QUARTER_37_ADDR A:0x6a0180a0
y.create.l HWIO_WCSS_A_TXFIR_COEFF_QUARTER_38_ADDR A:0x6a0180a4
y.create.l HWIO_WCSS_A_TXFIR_COEFF_QUARTER_39_ADDR A:0x6a0180a8
y.create.l HWIO_WCSS_A_TXFIR_COEFF_QUARTER_40_ADDR A:0x6a0180ac
y.create.l HWIO_WCSS_A_TXFIR_COEFF_QUARTER_41_ADDR A:0x6a0180b0
y.create.l HWIO_WCSS_A_TXFIR_COEFF_HALF_0_ADDR A:0x6a0180b4
y.create.l HWIO_WCSS_A_TXFIR_COEFF_HALF_1_ADDR A:0x6a0180b8
y.create.l HWIO_WCSS_A_TXFIR_COEFF_HALF_2_ADDR A:0x6a0180bc
y.create.l HWIO_WCSS_A_TXFIR_COEFF_HALF_3_ADDR A:0x6a0180c0
y.create.l HWIO_WCSS_A_TXFIR_COEFF_HALF_4_ADDR A:0x6a0180c4
y.create.l HWIO_WCSS_A_TXFIR_COEFF_HALF_5_ADDR A:0x6a0180c8
y.create.l HWIO_WCSS_A_TXFIR_COEFF_HALF_6_ADDR A:0x6a0180cc
y.create.l HWIO_WCSS_A_TXFIR_COEFF_HALF_7_ADDR A:0x6a0180d0
y.create.l HWIO_WCSS_A_TXFIR_COEFF_HALF_8_ADDR A:0x6a0180d4
y.create.l HWIO_WCSS_A_TXFIR_COEFF_HALF_9_ADDR A:0x6a0180d8
y.create.l HWIO_WCSS_A_TXFIR_COEFF_HALF_10_ADDR A:0x6a0180dc
y.create.l HWIO_WCSS_A_TXFIR_COEFF_HALF_11_ADDR A:0x6a0180e0
y.create.l HWIO_WCSS_A_TXFIR_COEFF_HALF_12_ADDR A:0x6a0180e4
y.create.l HWIO_WCSS_A_TXFIR_COEFF_HALF_13_ADDR A:0x6a0180e8
y.create.l HWIO_WCSS_A_TXFIR_COEFF_HALF_14_ADDR A:0x6a0180ec
y.create.l HWIO_WCSS_A_TXFIR_COEFF_HALF_15_ADDR A:0x6a0180f0
y.create.l HWIO_WCSS_A_TXFIR_COEFF_HALF_16_ADDR A:0x6a0180f4
y.create.l HWIO_WCSS_A_TXFIR_COEFF_HALF_17_ADDR A:0x6a0180f8
y.create.l HWIO_WCSS_A_TXFIR_COEFF_HALF_18_ADDR A:0x6a0180fc
y.create.l HWIO_WCSS_A_TXFIR_COEFF_HALF_19_ADDR A:0x6a018100
y.create.l HWIO_WCSS_A_TXFIR_COEFF_HALF_20_ADDR A:0x6a018104
y.create.l HWIO_WCSS_A_TXFIR_COEFF_HALF_21_ADDR A:0x6a018108
y.create.l HWIO_WCSS_A_TXFIR_COEFF_HALF_22_ADDR A:0x6a01810c
y.create.l HWIO_WCSS_A_TXFIR_COEFF_HALF_23_ADDR A:0x6a018110
y.create.l HWIO_WCSS_A_TXFIR_COEFF_HALF_24_ADDR A:0x6a018114
y.create.l HWIO_WCSS_A_TXFIR_COEFF_HALF_25_ADDR A:0x6a018118
y.create.l HWIO_WCSS_A_TXFIR_COEFF_HALF_26_ADDR A:0x6a01811c
y.create.l HWIO_WCSS_A_TXFIR_COEFF_HALF_27_ADDR A:0x6a018120
y.create.l HWIO_WCSS_A_TXFIR_COEFF_HALF_28_ADDR A:0x6a018124
y.create.l HWIO_WCSS_A_TXFIR_COEFF_HALF_29_ADDR A:0x6a018128
y.create.l HWIO_WCSS_A_TXFIR_COEFF_HALF_30_ADDR A:0x6a01812c
y.create.l HWIO_WCSS_A_TXFIR_COEFF_HALF_31_ADDR A:0x6a018130
y.create.l HWIO_WCSS_A_TXFIR_COEFF_HALF_32_ADDR A:0x6a018134
y.create.l HWIO_WCSS_A_TXFIR_COEFF_HALF_33_ADDR A:0x6a018138
y.create.l HWIO_WCSS_A_TXFIR_COEFF_HALF_34_ADDR A:0x6a01813c
y.create.l HWIO_WCSS_A_TXFIR_COEFF_HALF_35_ADDR A:0x6a018140
y.create.l HWIO_WCSS_A_TXFIR_COEFF_HALF_36_ADDR A:0x6a018144
y.create.l HWIO_WCSS_A_TXFIR_COEFF_HALF_37_ADDR A:0x6a018148
y.create.l HWIO_WCSS_A_TXFIR_COEFF_HALF_38_ADDR A:0x6a01814c
y.create.l HWIO_WCSS_A_TXFIR_COEFF_HALF_39_ADDR A:0x6a018150
y.create.l HWIO_WCSS_A_TXFIR_COEFF_HALF_40_ADDR A:0x6a018154
y.create.l HWIO_WCSS_A_TXFIR_COEFF_HALF_41_ADDR A:0x6a018158
y.create.l HWIO_WCSS_A_TXFIR_COEFF_FULL_0_ADDR A:0x6a01815c
y.create.l HWIO_WCSS_A_TXFIR_COEFF_FULL_1_ADDR A:0x6a018160
y.create.l HWIO_WCSS_A_TXFIR_COEFF_FULL_2_ADDR A:0x6a018164
y.create.l HWIO_WCSS_A_TXFIR_COEFF_FULL_3_ADDR A:0x6a018168
y.create.l HWIO_WCSS_A_TXFIR_COEFF_FULL_4_ADDR A:0x6a01816c
y.create.l HWIO_WCSS_A_TXFIR_COEFF_FULL_5_ADDR A:0x6a018170
y.create.l HWIO_WCSS_A_TXFIR_COEFF_FULL_6_ADDR A:0x6a018174
y.create.l HWIO_WCSS_A_TXFIR_COEFF_FULL_7_ADDR A:0x6a018178
y.create.l HWIO_WCSS_A_TXFIR_COEFF_FULL_8_ADDR A:0x6a01817c
y.create.l HWIO_WCSS_A_TXFIR_COEFF_FULL_9_ADDR A:0x6a018180
y.create.l HWIO_WCSS_A_TXFIR_COEFF_FULL_10_ADDR A:0x6a018184
y.create.l HWIO_WCSS_A_TXFIR_COEFF_FULL_11_ADDR A:0x6a018188
y.create.l HWIO_WCSS_A_TXFIR_COEFF_FULL_12_ADDR A:0x6a01818c
y.create.l HWIO_WCSS_A_TXFIR_COEFF_FULL_13_ADDR A:0x6a018190
y.create.l HWIO_WCSS_A_TXFIR_COEFF_FULL_14_ADDR A:0x6a018194
y.create.l HWIO_WCSS_A_TXFIR_COEFF_FULL_15_ADDR A:0x6a018198
y.create.l HWIO_WCSS_A_TXFIR_COEFF_FULL_16_ADDR A:0x6a01819c
y.create.l HWIO_WCSS_A_TXFIR_COEFF_FULL_17_ADDR A:0x6a0181a0
y.create.l HWIO_WCSS_A_TXFIR_COEFF_FULL_18_ADDR A:0x6a0181a4
y.create.l HWIO_WCSS_A_TXFIR_COEFF_FULL_19_ADDR A:0x6a0181a8
y.create.l HWIO_WCSS_A_TXFIR_COEFF_FULL_20_ADDR A:0x6a0181ac
y.create.l HWIO_WCSS_A_TXFIR_COEFF_FULL_21_ADDR A:0x6a0181b0
y.create.l HWIO_WCSS_A_TXFIR_COEFF_FULL_22_ADDR A:0x6a0181b4
y.create.l HWIO_WCSS_A_TXFIR_COEFF_FULL_23_ADDR A:0x6a0181b8
y.create.l HWIO_WCSS_A_TXFIR_COEFF_FULL_24_ADDR A:0x6a0181bc
y.create.l HWIO_WCSS_A_TXFIR_COEFF_FULL_25_ADDR A:0x6a0181c0
y.create.l HWIO_WCSS_A_TXFIR_COEFF_FULL_26_ADDR A:0x6a0181c4
y.create.l HWIO_WCSS_A_TXFIR_COEFF_FULL_27_ADDR A:0x6a0181c8
y.create.l HWIO_WCSS_A_TXFIR_COEFF_FULL_28_ADDR A:0x6a0181cc
y.create.l HWIO_WCSS_A_TXFIR_COEFF_FULL_29_ADDR A:0x6a0181d0
y.create.l HWIO_WCSS_A_TXFIR_COEFF_FULL_30_ADDR A:0x6a0181d4
y.create.l HWIO_WCSS_A_TXFIR_COEFF_FULL_31_ADDR A:0x6a0181d8
y.create.l HWIO_WCSS_A_TXFIR_COEFF_FULL_32_ADDR A:0x6a0181dc
y.create.l HWIO_WCSS_A_TXFIR_COEFF_FULL_33_ADDR A:0x6a0181e0
y.create.l HWIO_WCSS_A_TXFIR_COEFF_FULL_34_ADDR A:0x6a0181e4
y.create.l HWIO_WCSS_A_TXFIR_COEFF_FULL_35_ADDR A:0x6a0181e8
y.create.l HWIO_WCSS_A_TXFIR_COEFF_FULL_36_ADDR A:0x6a0181ec
y.create.l HWIO_WCSS_A_TXFIR_COEFF_FULL_37_ADDR A:0x6a0181f0
y.create.l HWIO_WCSS_A_TXFIR_COEFF_FULL_38_ADDR A:0x6a0181f4
y.create.l HWIO_WCSS_A_TXFIR_COEFF_FULL_39_ADDR A:0x6a0181f8
y.create.l HWIO_WCSS_A_TXFIR_COEFF_FULL_40_ADDR A:0x6a0181fc
y.create.l HWIO_WCSS_A_TXFIR_COEFF_FULL_41_ADDR A:0x6a018200
y.create.l HWIO_WCSS_A_TXFIR_COEFF_TXB_20_0_ADDR A:0x6a018204
y.create.l HWIO_WCSS_A_TXFIR_COEFF_TXB_20_1_ADDR A:0x6a018208
y.create.l HWIO_WCSS_A_TXFIR_COEFF_TXB_20_2_ADDR A:0x6a01820c
y.create.l HWIO_WCSS_A_TXFIR_COEFF_TXB_20_3_ADDR A:0x6a018210
y.create.l HWIO_WCSS_A_TXFIR_COEFF_TXB_20_4_ADDR A:0x6a018214
y.create.l HWIO_WCSS_A_TXFIR_COEFF_TXB_20_5_ADDR A:0x6a018218
y.create.l HWIO_WCSS_A_TXFIR_COEFF_TXB_20_6_ADDR A:0x6a01821c
y.create.l HWIO_WCSS_A_TXFIR_COEFF_TXB_20_7_ADDR A:0x6a018220
y.create.l HWIO_WCSS_A_TXFIR_COEFF_TXB_20_8_ADDR A:0x6a018224
y.create.l HWIO_WCSS_A_TXFIR_COEFF_TXB_20_9_ADDR A:0x6a018228
y.create.l HWIO_WCSS_A_TXFIR_COEFF_TXB_20_10_ADDR A:0x6a01822c
y.create.l HWIO_WCSS_A_TXFIR_COEFF_TXB_20_11_ADDR A:0x6a018230
y.create.l HWIO_WCSS_A_TXFIR_COEFF_TXB_20_12_ADDR A:0x6a018234
y.create.l HWIO_WCSS_A_TXFIR_COEFF_TXB_20_13_ADDR A:0x6a018238
y.create.l HWIO_WCSS_A_TXFIR_COEFF_TXB_20_14_ADDR A:0x6a01823c
y.create.l HWIO_WCSS_A_TXFIR_COEFF_TXB_20_15_ADDR A:0x6a018240
y.create.l HWIO_WCSS_A_TXFIR_COEFF_TXB_40_0_ADDR A:0x6a018244
y.create.l HWIO_WCSS_A_TXFIR_COEFF_TXB_40_1_ADDR A:0x6a018248
y.create.l HWIO_WCSS_A_TXFIR_COEFF_TXB_40_2_ADDR A:0x6a01824c
y.create.l HWIO_WCSS_A_TXFIR_COEFF_TXB_40_3_ADDR A:0x6a018250
y.create.l HWIO_WCSS_A_TXFIR_COEFF_TXB_40_4_ADDR A:0x6a018254
y.create.l HWIO_WCSS_A_TXFIR_COEFF_TXB_40_5_ADDR A:0x6a018258
y.create.l HWIO_WCSS_A_TXFIR_COEFF_TXB_40_6_ADDR A:0x6a01825c
y.create.l HWIO_WCSS_A_TXFIR_COEFF_TXB_40_7_ADDR A:0x6a018260
y.create.l HWIO_WCSS_A_TXFIR_COEFF_TXB_40_8_ADDR A:0x6a018264
y.create.l HWIO_WCSS_A_TXFIR_COEFF_TXB_40_9_ADDR A:0x6a018268
y.create.l HWIO_WCSS_A_TXFIR_COEFF_TXB_40_10_ADDR A:0x6a01826c
y.create.l HWIO_WCSS_A_TXFIR_COEFF_TXB_40_11_ADDR A:0x6a018270
y.create.l HWIO_WCSS_A_TXFIR_COEFF_TXB_40_12_ADDR A:0x6a018274
y.create.l HWIO_WCSS_A_TXFIR_COEFF_TXB_40_13_ADDR A:0x6a018278
y.create.l HWIO_WCSS_A_TXFIR_COEFF_TXB_40_14_ADDR A:0x6a01827c
y.create.l HWIO_WCSS_A_TXFIR_COEFF_TXB_40_15_ADDR A:0x6a018280
y.create.l HWIO_WCSS_A_TXFIR_COEFF_TXB_40_16_ADDR A:0x6a018284
y.create.l HWIO_WCSS_A_TXFIR_COEFF_TXB_40_17_ADDR A:0x6a018288
y.create.l HWIO_WCSS_A_TXFIR_COEFF_TXB_40_18_ADDR A:0x6a01828c
y.create.l HWIO_WCSS_A_TXFIR_COEFF_TXB_40_19_ADDR A:0x6a018290
y.create.l HWIO_WCSS_A_TXFIR_COEFF_TXB_40_20_ADDR A:0x6a018294
y.create.l HWIO_WCSS_A_TXFIR_COEFF_TXB_40_21_ADDR A:0x6a018298
y.create.l HWIO_WCSS_A_TXFIR_COEFF_TXB_40_22_ADDR A:0x6a01829c
y.create.l HWIO_WCSS_A_TXFIR_COEFF_TXB_40_23_ADDR A:0x6a0182a0
y.create.l HWIO_WCSS_A_TXFIR_COEFF_TXB_40_24_ADDR A:0x6a0182a4
y.create.l HWIO_WCSS_A_TXFIR_COEFF_TXB_40_25_ADDR A:0x6a0182a8
y.create.l HWIO_WCSS_A_TXFIR_COEFF_TXB_40_26_ADDR A:0x6a0182ac
y.create.l HWIO_WCSS_A_TXFIR_COEFF_TXB_40_27_ADDR A:0x6a0182b0
y.create.l HWIO_WCSS_A_TXFIR_COEFF_TXB_40_28_ADDR A:0x6a0182b4
y.create.l HWIO_WCSS_A_TXFIR_COEFF_TXB_40_29_ADDR A:0x6a0182b8
y.create.l HWIO_WCSS_A_TXFIR_COEFF_TXB_40_30_ADDR A:0x6a0182bc
y.create.l HWIO_WCSS_A_TXFIR_COEFF_TXB_40_31_ADDR A:0x6a0182c0
y.create.l HWIO_WCSS_A_TXFIR_COEFF_TXB_80_0_ADDR A:0x6a0182c4
y.create.l HWIO_WCSS_A_TXFIR_COEFF_TXB_80_1_ADDR A:0x6a0182c8
y.create.l HWIO_WCSS_A_TXFIR_COEFF_TXB_80_2_ADDR A:0x6a0182cc
y.create.l HWIO_WCSS_A_TXFIR_COEFF_TXB_80_3_ADDR A:0x6a0182d0
y.create.l HWIO_WCSS_A_TXFIR_COEFF_TXB_80_4_ADDR A:0x6a0182d4
y.create.l HWIO_WCSS_A_TXFIR_COEFF_TXB_80_5_ADDR A:0x6a0182d8
y.create.l HWIO_WCSS_A_TXFIR_COEFF_TXB_80_6_ADDR A:0x6a0182dc
y.create.l HWIO_WCSS_A_TXFIR_COEFF_TXB_80_7_ADDR A:0x6a0182e0
y.create.l HWIO_WCSS_A_TXFIR_COEFF_TXB_80_8_ADDR A:0x6a0182e4
y.create.l HWIO_WCSS_A_TXFIR_COEFF_TXB_80_9_ADDR A:0x6a0182e8
y.create.l HWIO_WCSS_A_TXFIR_COEFF_TXB_80_10_ADDR A:0x6a0182ec
y.create.l HWIO_WCSS_A_TXFIR_COEFF_TXB_80_11_ADDR A:0x6a0182f0
y.create.l HWIO_WCSS_A_TXFIR_COEFF_TXB_80_12_ADDR A:0x6a0182f4
y.create.l HWIO_WCSS_A_TXFIR_COEFF_TXB_80_13_ADDR A:0x6a0182f8
y.create.l HWIO_WCSS_A_TXFIR_COEFF_TXB_80_14_ADDR A:0x6a0182fc
y.create.l HWIO_WCSS_A_TXFIR_COEFF_TXB_80_15_ADDR A:0x6a018300
y.create.l HWIO_WCSS_A_TXFIR_COEFF_TXB_80_16_ADDR A:0x6a018304
y.create.l HWIO_WCSS_A_TXFIR_COEFF_TXB_80_17_ADDR A:0x6a018308
y.create.l HWIO_WCSS_A_TXFIR_COEFF_TXB_80_18_ADDR A:0x6a01830c
y.create.l HWIO_WCSS_A_TXFIR_COEFF_TXB_80_19_ADDR A:0x6a018310
y.create.l HWIO_WCSS_A_TXFIR_COEFF_TXB_80_20_ADDR A:0x6a018314
y.create.l HWIO_WCSS_A_TXFIR_COEFF_TXB_80_21_ADDR A:0x6a018318
y.create.l HWIO_WCSS_A_TXFIR_COEFF_TXB_80_22_ADDR A:0x6a01831c
y.create.l HWIO_WCSS_A_TXFIR_COEFF_TXB_80_23_ADDR A:0x6a018320
y.create.l HWIO_WCSS_A_TXFIR_COEFF_TXB_80_24_ADDR A:0x6a018324
y.create.l HWIO_WCSS_A_TXFIR_COEFF_TXB_80_25_ADDR A:0x6a018328
y.create.l HWIO_WCSS_A_TXFIR_COEFF_TXB_80_26_ADDR A:0x6a01832c
y.create.l HWIO_WCSS_A_TXFIR_COEFF_TXB_80_27_ADDR A:0x6a018330
y.create.l HWIO_WCSS_A_TXFIR_COEFF_TXB_80_28_ADDR A:0x6a018334
y.create.l HWIO_WCSS_A_TXFIR_COEFF_TXB_80_29_ADDR A:0x6a018338
y.create.l HWIO_WCSS_A_TXFIR_COEFF_TXB_80_30_ADDR A:0x6a01833c
y.create.l HWIO_WCSS_A_TXFIR_COEFF_TXB_80_31_ADDR A:0x6a018340
y.create.l HWIO_WCSS_A_TXFIR_COEFF_TXB_80_32_ADDR A:0x6a018344
y.create.l HWIO_WCSS_A_TXFIR_COEFF_TXB_80_33_ADDR A:0x6a018348
y.create.l HWIO_WCSS_A_TXFIR_COEFF_TXB_80_34_ADDR A:0x6a01834c
y.create.l HWIO_WCSS_A_TXFIR_COEFF_TXB_80_35_ADDR A:0x6a018350
y.create.l HWIO_WCSS_A_TXFIR_COEFF_TXB_80_36_ADDR A:0x6a018354
y.create.l HWIO_WCSS_A_TXFIR_COEFF_TXB_80_37_ADDR A:0x6a018358
y.create.l HWIO_WCSS_A_TXFIR_COEFF_TXB_80_38_ADDR A:0x6a01835c
y.create.l HWIO_WCSS_A_TXFIR_COEFF_TXB_80_39_ADDR A:0x6a018360
y.create.l HWIO_WCSS_A_TXFIR_COEFF_TXB_80_40_ADDR A:0x6a018364
y.create.l HWIO_WCSS_A_TXFIR_COEFF_TXB_80_41_ADDR A:0x6a018368
y.create.l HWIO_WCSS_A_TXFIR_COEFF_TXB_80_42_ADDR A:0x6a01836c
y.create.l HWIO_WCSS_A_TXFIR_COEFF_TXB_80_43_ADDR A:0x6a018370
y.create.l HWIO_WCSS_A_TXFIR_COEFF_TXB_80_44_ADDR A:0x6a018374
y.create.l HWIO_WCSS_A_TXFIR_COEFF_TXB_80_45_ADDR A:0x6a018378
y.create.l HWIO_WCSS_A_TXFIR_COEFF_TXB_80_46_ADDR A:0x6a01837c
y.create.l HWIO_WCSS_A_TXFIR_COEFF_TXB_80_47_ADDR A:0x6a018380
y.create.l HWIO_WCSS_A_TXFIR_COEFF_TXB_80_48_ADDR A:0x6a018384
y.create.l HWIO_WCSS_A_TXFIR_COEFF_TXB_80_49_ADDR A:0x6a018388
y.create.l HWIO_WCSS_A_TXFIR_COEFF_TXB_80_50_ADDR A:0x6a01838c
y.create.l HWIO_WCSS_A_TXFIR_COEFF_TXB_80_51_ADDR A:0x6a018390
y.create.l HWIO_WCSS_A_TXFIR_COEFF_TXB_80_52_ADDR A:0x6a018394
y.create.l HWIO_WCSS_A_TXFIR_COEFF_TXB_80_53_ADDR A:0x6a018398
y.create.l HWIO_WCSS_A_TXFIR_COEFF_TXB_80_54_ADDR A:0x6a01839c
y.create.l HWIO_WCSS_A_TXFIR_COEFF_TXB_80_55_ADDR A:0x6a0183a0
y.create.l HWIO_WCSS_A_TXFIR_COEFF_TXB_80_56_ADDR A:0x6a0183a4
y.create.l HWIO_WCSS_A_TXFIR_COEFF_TXB_80_57_ADDR A:0x6a0183a8
y.create.l HWIO_WCSS_A_TXFIR_COEFF_TXB_80_58_ADDR A:0x6a0183ac
y.create.l HWIO_WCSS_A_TXFIR_COEFF_TXB_80_59_ADDR A:0x6a0183b0
y.create.l HWIO_WCSS_A_TXFIR_COEFF_TXB_80_60_ADDR A:0x6a0183b4
y.create.l HWIO_WCSS_A_TXFIR_COEFF_TXB_80_61_ADDR A:0x6a0183b8
y.create.l HWIO_WCSS_A_TXFIR_COEFF_TXB_80_62_ADDR A:0x6a0183bc
y.create.l HWIO_WCSS_A_TXFIR_COEFF_TXB_80_63_ADDR A:0x6a0183c0
y.create.l HWIO_WCSS_A_TXFIR_COEFF_PEAKW_0_ADDR A:0x6a0183c4
y.create.l HWIO_WCSS_A_TXFIR_COEFF_PEAKW_1_ADDR A:0x6a0183c8
y.create.l HWIO_WCSS_A_TXFIR_COEFF_PEAKW_2_ADDR A:0x6a0183cc
y.create.l HWIO_WCSS_A_TXFIR_COEFF_PEAKW_3_ADDR A:0x6a0183d0
y.create.l HWIO_WCSS_A_TXFIR_COEFF_PEAKW_4_ADDR A:0x6a0183d4
y.create.l HWIO_WCSS_A_TXFIR_COEFF_PEAKW_5_ADDR A:0x6a0183d8
y.create.l HWIO_WCSS_A_TXFIR_COEFF_PEAKW_6_ADDR A:0x6a0183dc
y.create.l HWIO_WCSS_A_TXFIR_COEFF_PEAKW_7_ADDR A:0x6a0183e0
y.create.l HWIO_WCSS_A_TXFIR_COEFF_PEAKW_8_ADDR A:0x6a0183e4
y.create.l HWIO_WCSS_A_TXFIR_COEFF_PEAKW_9_ADDR A:0x6a0183e8
y.create.l HWIO_WCSS_A_TXFIR_COEFF_PEAKW_10_ADDR A:0x6a0183ec
y.create.l HWIO_WCSS_A_TXFIR_PEAKW_CLIP_THRESHOLD_0_ADDR A:0x6a0183f0
y.create.l HWIO_WCSS_A_TXFIR_PEAKW_CLIP_THRESHOLD_1_ADDR A:0x6a0183f4
y.create.l HWIO_WCSS_A_TXFIR_PEAKW_CLIP_THRESHOLD_2_ADDR A:0x6a0183f8
y.create.l HWIO_WCSS_A_TXFIR_PEAKW_CLIP_THRESHOLD_3_ADDR A:0x6a0183fc
y.create.l HWIO_WCSS_A_TXFIR_PEAKW_CLIP_THRESHOLD_4_ADDR A:0x6a018400
y.create.l HWIO_WCSS_A_TXFIR_PEAKW_CLIP_THRESHOLD_5_ADDR A:0x6a018404
y.create.l HWIO_WCSS_A_TXFIR_PEAKW_CLIP_THRESHOLD_6_ADDR A:0x6a018408
y.create.l HWIO_WCSS_A_TXFIR_PEAKW_CLIP_THRESHOLD_7_ADDR A:0x6a01840c
y.create.l HWIO_WCSS_A_TXFIR_PEAKW_CLIP_THRESHOLD_8_ADDR A:0x6a018410
y.create.l HWIO_WCSS_A_TXFIR_PEAKW_CLIP_THRESHOLD_9_ADDR A:0x6a018414
y.create.l HWIO_WCSS_A_TXFIR_PEAKW_CLIP_THRESHOLD_10_ADDR A:0x6a018418
y.create.l HWIO_WCSS_A_TXFIR_PEAKW_CLIP_THRESHOLD_11_ADDR A:0x6a01841c
y.create.l HWIO_WCSS_A_TXFIR_PEAKW_CLIP_THRESHOLD_12_ADDR A:0x6a018420
y.create.l HWIO_WCSS_A_TXFIR_PEAKW_CLIP_THRESHOLD_13_ADDR A:0x6a018424
y.create.l HWIO_WCSS_A_TXFIR_PEAKW_CLIP_THRESHOLD_14_ADDR A:0x6a018428
y.create.l HWIO_WCSS_A_TXFIR_PEAKW_CLIP_THRESHOLD_15_ADDR A:0x6a01842c
y.create.l HWIO_WCSS_A_TXFIR_PEAKW_CLIP_THRESHOLD_16_ADDR A:0x6a018430
y.create.l HWIO_WCSS_A_TXFIR_PEAKW_CLIP_THRESHOLD_17_ADDR A:0x6a018434
y.create.l HWIO_WCSS_A_TXFIR_PEAKW_CLIP_THRESHOLD_18_ADDR A:0x6a018438
y.create.l HWIO_WCSS_A_TXFIR_PEAKW_CLIP_THRESHOLD_19_ADDR A:0x6a01843c
y.create.l HWIO_WCSS_A_TXFIR_PEAKW_CLIP_THRESHOLD_20_ADDR A:0x6a018440
y.create.l HWIO_WCSS_A_TXFIR_PEAKW_CLIP_THRESHOLD_21_ADDR A:0x6a018444
y.create.l HWIO_WCSS_A_TXFIR_PEAKW_CLIP_THRESHOLD_22_ADDR A:0x6a018448
y.create.l HWIO_WCSS_A_TXFIR_PEAKW_CLIP_THRESHOLD_23_ADDR A:0x6a01844c
y.create.l HWIO_WCSS_A_TXFIR_PEAKW_CLIP_THRESHOLD_24_ADDR A:0x6a018450
y.create.l HWIO_WCSS_A_TXFIR_PEAKW_CLIP_THRESHOLD_25_ADDR A:0x6a018454
y.create.l HWIO_WCSS_A_TXFIR_PEAKW_CLIP_THRESHOLD_26_ADDR A:0x6a018458
y.create.l HWIO_WCSS_A_TXFIR_PEAKW_CLIP_THRESHOLD_27_ADDR A:0x6a01845c
y.create.l HWIO_WCSS_A_TXFIR_PEAKW_CLIP_THRESHOLD_28_ADDR A:0x6a018460
y.create.l HWIO_WCSS_A_TXFIR_PEAKW_CLIP_THRESHOLD_29_ADDR A:0x6a018464
y.create.l HWIO_WCSS_A_TXFIR_PEAKW_CLIP_THRESHOLD_30_ADDR A:0x6a018468
y.create.l HWIO_WCSS_A_TXFIR_PEAKW_CLIP_THRESHOLD_31_ADDR A:0x6a01846c
y.create.l HWIO_WCSS_A_TXFIR_Q_INVERT_ADDR A:0x6a018470
y.create.l HWIO_WCSS_A_TXFIR_INTERP_X2_ADDR A:0x6a018474
y.create.l HWIO_WCSS_A_TXFIR_IQCORR_CENTRE_TAP_ADDR A:0x6a018478
y.create.l HWIO_WCSS_A_TXFIR_GAIN_OFFSET_OFDM_ADDR A:0x6a01847c
y.create.l HWIO_WCSS_A_TXFIR_FINEGAIN_OFFSET_ADDR A:0x6a018480
y.create.l HWIO_WCSS_A_TXFIR_GAIN_OFFSET_11B_ADDR A:0x6a018484
y.create.l HWIO_WCSS_A_TXFIR_TXFIR_FIFO_RESET_ADDR A:0x6a018488
y.create.l HWIO_WCSS_A_TXFIR_TXCAL_MEM00_0_ADDR A:0x6a018800
y.create.l HWIO_WCSS_A_TXFIR_TXCAL_MEM01_0_ADDR A:0x6a018820
y.create.l HWIO_WCSS_A_TXFIR_TXCAL_MEM02_0_ADDR A:0x6a018840
y.create.l HWIO_WCSS_A_TXFIR_TXCAL_MEM03_0_ADDR A:0x6a018860
y.create.l HWIO_WCSS_A_TXFIR_TXCAL_MEM04_0_ADDR A:0x6a018880
y.create.l HWIO_WCSS_A_TXFIR_TXCAL_MEM05_0_ADDR A:0x6a0188a0
y.create.l HWIO_WCSS_A_TXFIR_TXCAL_MEM06_0_ADDR A:0x6a0188c0
y.create.l HWIO_WCSS_A_TXFIR_TXCAL_MEM07_0_ADDR A:0x6a0188e0
y.create.l HWIO_WCSS_A_TXFIR_TXCAL_MEM08_0_ADDR A:0x6a018900
y.create.l HWIO_WCSS_A_TXFIR_TXCAL_MEM09_0_ADDR A:0x6a018920
y.create.l HWIO_WCSS_A_TXFIR_TXCAL_MEM00_1_ADDR A:0x6a018804
y.create.l HWIO_WCSS_A_TXFIR_TXCAL_MEM01_1_ADDR A:0x6a018824
y.create.l HWIO_WCSS_A_TXFIR_TXCAL_MEM02_1_ADDR A:0x6a018844
y.create.l HWIO_WCSS_A_TXFIR_TXCAL_MEM03_1_ADDR A:0x6a018864
y.create.l HWIO_WCSS_A_TXFIR_TXCAL_MEM04_1_ADDR A:0x6a018884
y.create.l HWIO_WCSS_A_TXFIR_TXCAL_MEM05_1_ADDR A:0x6a0188a4
y.create.l HWIO_WCSS_A_TXFIR_TXCAL_MEM06_1_ADDR A:0x6a0188c4
y.create.l HWIO_WCSS_A_TXFIR_TXCAL_MEM07_1_ADDR A:0x6a0188e4
y.create.l HWIO_WCSS_A_TXFIR_TXCAL_MEM08_1_ADDR A:0x6a018904
y.create.l HWIO_WCSS_A_TXFIR_TXCAL_MEM09_1_ADDR A:0x6a018924
y.create.l HWIO_WCSS_A_TXFIR_TXCAL_MEM00_2_ADDR A:0x6a018808
y.create.l HWIO_WCSS_A_TXFIR_TXCAL_MEM01_2_ADDR A:0x6a018828
y.create.l HWIO_WCSS_A_TXFIR_TXCAL_MEM02_2_ADDR A:0x6a018848
y.create.l HWIO_WCSS_A_TXFIR_TXCAL_MEM03_2_ADDR A:0x6a018868
y.create.l HWIO_WCSS_A_TXFIR_TXCAL_MEM04_2_ADDR A:0x6a018888
y.create.l HWIO_WCSS_A_TXFIR_TXCAL_MEM05_2_ADDR A:0x6a0188a8
y.create.l HWIO_WCSS_A_TXFIR_TXCAL_MEM06_2_ADDR A:0x6a0188c8
y.create.l HWIO_WCSS_A_TXFIR_TXCAL_MEM07_2_ADDR A:0x6a0188e8
y.create.l HWIO_WCSS_A_TXFIR_TXCAL_MEM08_2_ADDR A:0x6a018908
y.create.l HWIO_WCSS_A_TXFIR_TXCAL_MEM09_2_ADDR A:0x6a018928
y.create.l HWIO_WCSS_A_TXFIR_TXCAL_MEM00_3_ADDR A:0x6a01880c
y.create.l HWIO_WCSS_A_TXFIR_TXCAL_MEM01_3_ADDR A:0x6a01882c
y.create.l HWIO_WCSS_A_TXFIR_TXCAL_MEM02_3_ADDR A:0x6a01884c
y.create.l HWIO_WCSS_A_TXFIR_TXCAL_MEM03_3_ADDR A:0x6a01886c
y.create.l HWIO_WCSS_A_TXFIR_TXCAL_MEM04_3_ADDR A:0x6a01888c
y.create.l HWIO_WCSS_A_TXFIR_TXCAL_MEM05_3_ADDR A:0x6a0188ac
y.create.l HWIO_WCSS_A_TXFIR_TXCAL_MEM06_3_ADDR A:0x6a0188cc
y.create.l HWIO_WCSS_A_TXFIR_TXCAL_MEM07_3_ADDR A:0x6a0188ec
y.create.l HWIO_WCSS_A_TXFIR_TXCAL_MEM08_3_ADDR A:0x6a01890c
y.create.l HWIO_WCSS_A_TXFIR_TXCAL_MEM09_3_ADDR A:0x6a01892c
y.create.l HWIO_WCSS_A_TXFIR_TXCAL_MEM00_4_ADDR A:0x6a018810
y.create.l HWIO_WCSS_A_TXFIR_TXCAL_MEM01_4_ADDR A:0x6a018830
y.create.l HWIO_WCSS_A_TXFIR_TXCAL_MEM02_4_ADDR A:0x6a018850
y.create.l HWIO_WCSS_A_TXFIR_TXCAL_MEM03_4_ADDR A:0x6a018870
y.create.l HWIO_WCSS_A_TXFIR_TXCAL_MEM04_4_ADDR A:0x6a018890
y.create.l HWIO_WCSS_A_TXFIR_TXCAL_MEM05_4_ADDR A:0x6a0188b0
y.create.l HWIO_WCSS_A_TXFIR_TXCAL_MEM06_4_ADDR A:0x6a0188d0
y.create.l HWIO_WCSS_A_TXFIR_TXCAL_MEM07_4_ADDR A:0x6a0188f0
y.create.l HWIO_WCSS_A_TXFIR_TXCAL_MEM08_4_ADDR A:0x6a018910
y.create.l HWIO_WCSS_A_TXFIR_TXCAL_MEM09_4_ADDR A:0x6a018930
y.create.l HWIO_WCSS_A_TXFIR_TXCAL_MEM00_5_ADDR A:0x6a018814
y.create.l HWIO_WCSS_A_TXFIR_TXCAL_MEM01_5_ADDR A:0x6a018834
y.create.l HWIO_WCSS_A_TXFIR_TXCAL_MEM02_5_ADDR A:0x6a018854
y.create.l HWIO_WCSS_A_TXFIR_TXCAL_MEM03_5_ADDR A:0x6a018874
y.create.l HWIO_WCSS_A_TXFIR_TXCAL_MEM04_5_ADDR A:0x6a018894
y.create.l HWIO_WCSS_A_TXFIR_TXCAL_MEM05_5_ADDR A:0x6a0188b4
y.create.l HWIO_WCSS_A_TXFIR_TXCAL_MEM06_5_ADDR A:0x6a0188d4
y.create.l HWIO_WCSS_A_TXFIR_TXCAL_MEM07_5_ADDR A:0x6a0188f4
y.create.l HWIO_WCSS_A_TXFIR_TXCAL_MEM08_5_ADDR A:0x6a018914
y.create.l HWIO_WCSS_A_TXFIR_TXCAL_MEM09_5_ADDR A:0x6a018934
y.create.l HWIO_WCSS_A_TXFIR_TXCAL_MEM00_6_ADDR A:0x6a018818
y.create.l HWIO_WCSS_A_TXFIR_TXCAL_MEM01_6_ADDR A:0x6a018838
y.create.l HWIO_WCSS_A_TXFIR_TXCAL_MEM02_6_ADDR A:0x6a018858
y.create.l HWIO_WCSS_A_TXFIR_TXCAL_MEM03_6_ADDR A:0x6a018878
y.create.l HWIO_WCSS_A_TXFIR_TXCAL_MEM04_6_ADDR A:0x6a018898
y.create.l HWIO_WCSS_A_TXFIR_TXCAL_MEM05_6_ADDR A:0x6a0188b8
y.create.l HWIO_WCSS_A_TXFIR_TXCAL_MEM06_6_ADDR A:0x6a0188d8
y.create.l HWIO_WCSS_A_TXFIR_TXCAL_MEM07_6_ADDR A:0x6a0188f8
y.create.l HWIO_WCSS_A_TXFIR_TXCAL_MEM08_6_ADDR A:0x6a018918
y.create.l HWIO_WCSS_A_TXFIR_TXCAL_MEM09_6_ADDR A:0x6a018938
y.create.l HWIO_WCSS_A_TXFIR_DPD_MEM00_0_ADDR A:0x6a019000
y.create.l HWIO_WCSS_A_TXFIR_DPD_MEM01_0_ADDR A:0x6a019010
y.create.l HWIO_WCSS_A_TXFIR_DPD_MEM02_0_ADDR A:0x6a019020
y.create.l HWIO_WCSS_A_TXFIR_DPD_MEM03_0_ADDR A:0x6a019030
y.create.l HWIO_WCSS_A_TXFIR_DPD_MEM04_0_ADDR A:0x6a019040
y.create.l HWIO_WCSS_A_TXFIR_DPD_MEM05_0_ADDR A:0x6a019050
y.create.l HWIO_WCSS_A_TXFIR_DPD_MEM06_0_ADDR A:0x6a019060
y.create.l HWIO_WCSS_A_TXFIR_DPD_MEM07_0_ADDR A:0x6a019070
y.create.l HWIO_WCSS_A_TXFIR_DPD_MEM08_0_ADDR A:0x6a019080
y.create.l HWIO_WCSS_A_TXFIR_DPD_MEM09_0_ADDR A:0x6a019090
y.create.l HWIO_WCSS_A_TXFIR_DPD_MEM00_1_ADDR A:0x6a019004
y.create.l HWIO_WCSS_A_TXFIR_DPD_MEM01_1_ADDR A:0x6a019014
y.create.l HWIO_WCSS_A_TXFIR_DPD_MEM02_1_ADDR A:0x6a019024
y.create.l HWIO_WCSS_A_TXFIR_DPD_MEM03_1_ADDR A:0x6a019034
y.create.l HWIO_WCSS_A_TXFIR_DPD_MEM04_1_ADDR A:0x6a019044
y.create.l HWIO_WCSS_A_TXFIR_DPD_MEM05_1_ADDR A:0x6a019054
y.create.l HWIO_WCSS_A_TXFIR_DPD_MEM06_1_ADDR A:0x6a019064
y.create.l HWIO_WCSS_A_TXFIR_DPD_MEM07_1_ADDR A:0x6a019074
y.create.l HWIO_WCSS_A_TXFIR_DPD_MEM08_1_ADDR A:0x6a019084
y.create.l HWIO_WCSS_A_TXFIR_DPD_MEM09_1_ADDR A:0x6a019094
y.create.l HWIO_WCSS_A_TXFIR_DPD_MEM00_2_ADDR A:0x6a019008
y.create.l HWIO_WCSS_A_TXFIR_DPD_MEM01_2_ADDR A:0x6a019018
y.create.l HWIO_WCSS_A_TXFIR_DPD_MEM02_2_ADDR A:0x6a019028
y.create.l HWIO_WCSS_A_TXFIR_DPD_MEM03_2_ADDR A:0x6a019038
y.create.l HWIO_WCSS_A_TXFIR_DPD_MEM04_2_ADDR A:0x6a019048
y.create.l HWIO_WCSS_A_TXFIR_DPD_MEM05_2_ADDR A:0x6a019058
y.create.l HWIO_WCSS_A_TXFIR_DPD_MEM06_2_ADDR A:0x6a019068
y.create.l HWIO_WCSS_A_TXFIR_DPD_MEM07_2_ADDR A:0x6a019078
y.create.l HWIO_WCSS_A_TXFIR_DPD_MEM08_2_ADDR A:0x6a019088
y.create.l HWIO_WCSS_A_TXFIR_DPD_MEM09_2_ADDR A:0x6a019098
y.create.l HWIO_WCSS_A_TXFIR_DPD_MEM00_3_ADDR A:0x6a01900c
y.create.l HWIO_WCSS_A_TXFIR_DPD_MEM01_3_ADDR A:0x6a01901c
y.create.l HWIO_WCSS_A_TXFIR_DPD_MEM02_3_ADDR A:0x6a01902c
y.create.l HWIO_WCSS_A_TXFIR_DPD_MEM03_3_ADDR A:0x6a01903c
y.create.l HWIO_WCSS_A_TXFIR_DPD_MEM04_3_ADDR A:0x6a01904c
y.create.l HWIO_WCSS_A_TXFIR_DPD_MEM05_3_ADDR A:0x6a01905c
y.create.l HWIO_WCSS_A_TXFIR_DPD_MEM06_3_ADDR A:0x6a01906c
y.create.l HWIO_WCSS_A_TXFIR_DPD_MEM07_3_ADDR A:0x6a01907c
y.create.l HWIO_WCSS_A_TXFIR_DPD_MEM08_3_ADDR A:0x6a01908c
y.create.l HWIO_WCSS_A_TXFIR_DPD_MEM09_3_ADDR A:0x6a01909c
y.create.l HWIO_WCSS_A_TXP_TXP_CMDF_DIN_ADDR A:0x6a080400
y.create.l HWIO_WCSS_A_TXP_TXP_CMDF_CONTROL_ADDR A:0x6a080404
y.create.l HWIO_WCSS_A_TXP_TXP_TIMEOUT_TIMER_ADDR A:0x6a080408
y.create.l HWIO_WCSS_A_TXP_TXP_STATUS_ADDR A:0x6a08040c
y.create.l HWIO_WCSS_A_TXP_TXP_BTC_ACTIVE_ABORT_ENABLE_ADDR A:0x6a080410
y.create.l HWIO_WCSS_A_TXP_TXP_TESTBUS_ADDR A:0x6a080414
y.create.l HWIO_WCSS_A_TXP_TXP_WARMUP_CNTL_ADDR A:0x6a080418
y.create.l HWIO_WCSS_A_TXP_TXP_TXFIFO_CTRL_ADDR A:0x6a080420
y.create.l HWIO_WCSS_A_TXP_TXP_DEBUG_CLEAR_ADDR A:0x6a080480
y.create.l HWIO_WCSS_A_TXP_TXP_NR_FRAMES_XMIT_ADDR A:0x6a080484
y.create.l HWIO_WCSS_A_TXP_TXP_PHY_ABORTS_ADDR A:0x6a080488
y.create.l HWIO_WCSS_A_TXP_TXP_NR_END_INTERRUPTS_ADDR A:0x6a08048c
y.create.l HWIO_WCSS_A_TXP_TXP_NR_CMDS_ADDR A:0x6a080490
y.create.l HWIO_WCSS_A_TXP_TXP_FSM_STATUS_ADDR A:0x6a080494
y.create.l HWIO_WCSS_A_TXP_TXP_DBG_STATUS_ADDR A:0x6a080498
y.create.l HWIO_WCSS_A_TXP_TXP_NR_MPI_ADDR A:0x6a08049c
y.create.l HWIO_XPU_CFG_PCNOC_CFG_XPU_SCR_ADDR A:0x6002e000
y.create.l HWIO_XPU_CFG_PCNOC_CFG_XPU_SWDR_ADDR A:0x6002e004
y.create.l HWIO_XPU_CFG_PCNOC_CFG_XPU_PRTN_RACR_SSHADOW_ADDR A:0x6002e008
y.create.l HWIO_XPU_CFG_PCNOC_CFG_XPU_PRTN_WACR_SSHADOW_ADDR A:0x6002e00c
y.create.l HWIO_XPU_CFG_PCNOC_CFG_XPU_PRTN_START_SSHADOW0_ADDR A:0x6002e010
y.create.l HWIO_XPU_CFG_PCNOC_CFG_XPU_PRTN_END_SSHADOW0_ADDR A:0x6002e018
y.create.l HWIO_XPU_CFG_PCNOC_CFG_XPU_SEAR0_ADDR A:0x6002e040
y.create.l HWIO_XPU_CFG_PCNOC_CFG_XPU_SESR_ADDR A:0x6002e048
y.create.l HWIO_XPU_CFG_PCNOC_CFG_XPU_SESRRESTORE_ADDR A:0x6002e04c
y.create.l HWIO_XPU_CFG_PCNOC_CFG_XPU_SESYNR0_ADDR A:0x6002e050
y.create.l HWIO_XPU_CFG_PCNOC_CFG_XPU_SESYNR1_ADDR A:0x6002e054
y.create.l HWIO_XPU_CFG_PCNOC_CFG_XPU_SESYNR2_ADDR A:0x6002e058
y.create.l HWIO_XPU_CFG_PCNOC_CFG_XPU_MCR_ADDR A:0x6002e100
y.create.l HWIO_XPU_CFG_PCNOC_CFG_XPU_MEAR0_ADDR A:0x6002e140
y.create.l HWIO_XPU_CFG_PCNOC_CFG_XPU_MESR_ADDR A:0x6002e148
y.create.l HWIO_XPU_CFG_PCNOC_CFG_XPU_MESRRESTORE_ADDR A:0x6002e14c
y.create.l HWIO_XPU_CFG_PCNOC_CFG_XPU_MESYNR0_ADDR A:0x6002e150
y.create.l HWIO_XPU_CFG_PCNOC_CFG_XPU_MESYNR1_ADDR A:0x6002e154
y.create.l HWIO_XPU_CFG_PCNOC_CFG_XPU_MESYNR2_ADDR A:0x6002e158
y.create.l HWIO_XPU_CFG_PCNOC_CFG_XPU_CR_ADDR A:0x6002e080
y.create.l HWIO_XPU_CFG_PCNOC_CFG_XPU_PRTN_RACR_SHADOW_ADDR A:0x6002e088
y.create.l HWIO_XPU_CFG_PCNOC_CFG_XPU_PRTN_WACR_SHADOW_ADDR A:0x6002e08c
y.create.l HWIO_XPU_CFG_PCNOC_CFG_XPU_PRTN_START_SHADOW0_ADDR A:0x6002e090
y.create.l HWIO_XPU_CFG_PCNOC_CFG_XPU_PRTN_END_SHADOW0_ADDR A:0x6002e098
y.create.l HWIO_XPU_CFG_PCNOC_CFG_XPU_RPU_ACR0_ADDR A:0x6002e0a0
y.create.l HWIO_XPU_CFG_PCNOC_CFG_XPU_EAR0_ADDR A:0x6002e0c0
y.create.l HWIO_XPU_CFG_PCNOC_CFG_XPU_ESR_ADDR A:0x6002e0c8
y.create.l HWIO_XPU_CFG_PCNOC_CFG_XPU_ESRRESTORE_ADDR A:0x6002e0cc
y.create.l HWIO_XPU_CFG_PCNOC_CFG_XPU_ESYNR0_ADDR A:0x6002e0d0
y.create.l HWIO_XPU_CFG_PCNOC_CFG_XPU_ESYNR1_ADDR A:0x6002e0d4
y.create.l HWIO_XPU_CFG_PCNOC_CFG_XPU_ESYNR2_ADDR A:0x6002e0d8
y.create.l HWIO_XPU_CFG_PCNOC_CFG_XPU_UMR_RACR_ADDR A:0x6002e0e0
y.create.l HWIO_XPU_CFG_PCNOC_CFG_XPU_UMR_WACR_ADDR A:0x6002e0e4
y.create.l HWIO_XPU_CFG_PCNOC_CFG_XPU_UMR_CNTL_ADDR A:0x6002e0f0
y.create.l HWIO_XPU_CFG_PCNOC_CFG_XPU_IDR0_ADDR A:0x6002e074
y.create.l HWIO_XPU_CFG_PCNOC_CFG_XPU_IDR1_ADDR A:0x6002e078
y.create.l HWIO_XPU_CFG_PCNOC_CFG_XPU_REV_ADDR A:0x6002e07c
y.create.l HWIO_XPU_CFG_PCNOC_CFG_XPU_PRT0_RACR0_ADDR A:0x6002e200
y.create.l HWIO_XPU_CFG_PCNOC_CFG_XPU_PRT1_RACR0_ADDR A:0x6002e280
y.create.l HWIO_XPU_CFG_PCNOC_CFG_XPU_PRT2_RACR0_ADDR A:0x6002e300
y.create.l HWIO_XPU_CFG_PCNOC_CFG_XPU_PRT3_RACR0_ADDR A:0x6002e380
y.create.l HWIO_XPU_CFG_PCNOC_CFG_XPU_PRT0_WACR0_ADDR A:0x6002e220
y.create.l HWIO_XPU_CFG_PCNOC_CFG_XPU_PRT1_WACR0_ADDR A:0x6002e2a0
y.create.l HWIO_XPU_CFG_PCNOC_CFG_XPU_PRT2_WACR0_ADDR A:0x6002e320
y.create.l HWIO_XPU_CFG_PCNOC_CFG_XPU_PRT3_WACR0_ADDR A:0x6002e3a0
y.create.l HWIO_XPU_CFG_PCNOC_CFG_XPU_PRT0_START0_ADDR A:0x6002e240
y.create.l HWIO_XPU_CFG_PCNOC_CFG_XPU_PRT1_START0_ADDR A:0x6002e2c0
y.create.l HWIO_XPU_CFG_PCNOC_CFG_XPU_PRT2_START0_ADDR A:0x6002e340
y.create.l HWIO_XPU_CFG_PCNOC_CFG_XPU_PRT3_START0_ADDR A:0x6002e3c0
y.create.l HWIO_XPU_CFG_PCNOC_CFG_XPU_PRT0_END0_ADDR A:0x6002e248
y.create.l HWIO_XPU_CFG_PCNOC_CFG_XPU_PRT1_END0_ADDR A:0x6002e2c8
y.create.l HWIO_XPU_CFG_PCNOC_CFG_XPU_PRT2_END0_ADDR A:0x6002e348
y.create.l HWIO_XPU_CFG_PCNOC_CFG_XPU_PRT3_END0_ADDR A:0x6002e3c8
y.create.l HWIO_XPU_CFG_PCNOC_CFG_XPU_PRT0_SCR_ADDR A:0x6002e250
y.create.l HWIO_XPU_CFG_PCNOC_CFG_XPU_PRT1_SCR_ADDR A:0x6002e2d0
y.create.l HWIO_XPU_CFG_PCNOC_CFG_XPU_PRT2_SCR_ADDR A:0x6002e350
y.create.l HWIO_XPU_CFG_PCNOC_CFG_XPU_PRT3_SCR_ADDR A:0x6002e3d0
y.create.l HWIO_XPU_CFG_PCNOC_CFG_XPU_PRT0_MCR_ADDR A:0x6002e254
y.create.l HWIO_XPU_CFG_PCNOC_CFG_XPU_PRT1_MCR_ADDR A:0x6002e2d4
y.create.l HWIO_XPU_CFG_PCNOC_CFG_XPU_PRT2_MCR_ADDR A:0x6002e354
y.create.l HWIO_XPU_CFG_PCNOC_CFG_XPU_PRT3_MCR_ADDR A:0x6002e3d4
y.create.l HWIO_XPU_CFG_PCNOC_CFG_XPU_PRT0_CNTL0_ADDR A:0x6002e258
y.create.l HWIO_XPU_CFG_PCNOC_CFG_XPU_PRT1_CNTL0_ADDR A:0x6002e2d8
y.create.l HWIO_XPU_CFG_PCNOC_CFG_XPU_PRT2_CNTL0_ADDR A:0x6002e358
y.create.l HWIO_XPU_CFG_PCNOC_CFG_XPU_PRT3_CNTL0_ADDR A:0x6002e3d8
y.create.l HWIO_XPU_CFG_PCNOC_CFG_XPU_PRT0_CNTL1_ADDR A:0x6002e25c
y.create.l HWIO_XPU_CFG_PCNOC_CFG_XPU_PRT1_CNTL1_ADDR A:0x6002e2dc
y.create.l HWIO_XPU_CFG_PCNOC_CFG_XPU_PRT2_CNTL1_ADDR A:0x6002e35c
y.create.l HWIO_XPU_CFG_PCNOC_CFG_XPU_PRT3_CNTL1_ADDR A:0x6002e3dc
y.create.l HWIO_XPU_CFG_PRNG_CFG_XPU_SCR_ADDR A:0x6002f000
y.create.l HWIO_XPU_CFG_PRNG_CFG_XPU_SWDR_ADDR A:0x6002f004
y.create.l HWIO_XPU_CFG_PRNG_CFG_XPU_SEAR0_ADDR A:0x6002f040
y.create.l HWIO_XPU_CFG_PRNG_CFG_XPU_SESR_ADDR A:0x6002f048
y.create.l HWIO_XPU_CFG_PRNG_CFG_XPU_SESRRESTORE_ADDR A:0x6002f04c
y.create.l HWIO_XPU_CFG_PRNG_CFG_XPU_SESYNR0_ADDR A:0x6002f050
y.create.l HWIO_XPU_CFG_PRNG_CFG_XPU_SESYNR1_ADDR A:0x6002f054
y.create.l HWIO_XPU_CFG_PRNG_CFG_XPU_SESYNR2_ADDR A:0x6002f058
y.create.l HWIO_XPU_CFG_PRNG_CFG_XPU_MCR_ADDR A:0x6002f100
y.create.l HWIO_XPU_CFG_PRNG_CFG_XPU_MEAR0_ADDR A:0x6002f140
y.create.l HWIO_XPU_CFG_PRNG_CFG_XPU_MESR_ADDR A:0x6002f148
y.create.l HWIO_XPU_CFG_PRNG_CFG_XPU_MESRRESTORE_ADDR A:0x6002f14c
y.create.l HWIO_XPU_CFG_PRNG_CFG_XPU_MESYNR0_ADDR A:0x6002f150
y.create.l HWIO_XPU_CFG_PRNG_CFG_XPU_MESYNR1_ADDR A:0x6002f154
y.create.l HWIO_XPU_CFG_PRNG_CFG_XPU_MESYNR2_ADDR A:0x6002f158
y.create.l HWIO_XPU_CFG_PRNG_CFG_XPU_CR_ADDR A:0x6002f080
y.create.l HWIO_XPU_CFG_PRNG_CFG_XPU_RPU_ACR0_ADDR A:0x6002f0a0
y.create.l HWIO_XPU_CFG_PRNG_CFG_XPU_EAR0_ADDR A:0x6002f0c0
y.create.l HWIO_XPU_CFG_PRNG_CFG_XPU_ESR_ADDR A:0x6002f0c8
y.create.l HWIO_XPU_CFG_PRNG_CFG_XPU_ESRRESTORE_ADDR A:0x6002f0cc
y.create.l HWIO_XPU_CFG_PRNG_CFG_XPU_ESYNR0_ADDR A:0x6002f0d0
y.create.l HWIO_XPU_CFG_PRNG_CFG_XPU_ESYNR1_ADDR A:0x6002f0d4
y.create.l HWIO_XPU_CFG_PRNG_CFG_XPU_ESYNR2_ADDR A:0x6002f0d8
y.create.l HWIO_XPU_CFG_PRNG_CFG_XPU_IDR0_ADDR A:0x6002f074
y.create.l HWIO_XPU_CFG_PRNG_CFG_XPU_IDR1_ADDR A:0x6002f078
y.create.l HWIO_XPU_CFG_PRNG_CFG_XPU_REV_ADDR A:0x6002f07c
y.create.l HWIO_XPU_CFG_PRNG_CFG_XPU_RG0_RACR0_ADDR A:0x6002f200
y.create.l HWIO_XPU_CFG_PRNG_CFG_XPU_RG0_WACR0_ADDR A:0x6002f220
y.create.l HWIO_XPU_CFG_PRNG_CFG_XPU_RG0_SCR_ADDR A:0x6002f250
y.create.l HWIO_XPU_CFG_PRNG_CFG_XPU_RG0_MCR_ADDR A:0x6002f254
y.create.l HWIO_XPU_CFG_RPM_CFG_XPU_SCR_ADDR A:0x60033000
y.create.l HWIO_XPU_CFG_RPM_CFG_XPU_SWDR_ADDR A:0x60033004
y.create.l HWIO_XPU_CFG_RPM_CFG_XPU_PRTN_RACR_SSHADOW_ADDR A:0x60033008
y.create.l HWIO_XPU_CFG_RPM_CFG_XPU_PRTN_WACR_SSHADOW_ADDR A:0x6003300c
y.create.l HWIO_XPU_CFG_RPM_CFG_XPU_PRTN_START_SSHADOW0_ADDR A:0x60033010
y.create.l HWIO_XPU_CFG_RPM_CFG_XPU_PRTN_END_SSHADOW0_ADDR A:0x60033018
y.create.l HWIO_XPU_CFG_RPM_CFG_XPU_SEAR0_ADDR A:0x60033040
y.create.l HWIO_XPU_CFG_RPM_CFG_XPU_SESR_ADDR A:0x60033048
y.create.l HWIO_XPU_CFG_RPM_CFG_XPU_SESRRESTORE_ADDR A:0x6003304c
y.create.l HWIO_XPU_CFG_RPM_CFG_XPU_SESYNR0_ADDR A:0x60033050
y.create.l HWIO_XPU_CFG_RPM_CFG_XPU_SESYNR1_ADDR A:0x60033054
y.create.l HWIO_XPU_CFG_RPM_CFG_XPU_SESYNR2_ADDR A:0x60033058
y.create.l HWIO_XPU_CFG_RPM_CFG_XPU_MCR_ADDR A:0x60033100
y.create.l HWIO_XPU_CFG_RPM_CFG_XPU_MEAR0_ADDR A:0x60033140
y.create.l HWIO_XPU_CFG_RPM_CFG_XPU_MESR_ADDR A:0x60033148
y.create.l HWIO_XPU_CFG_RPM_CFG_XPU_MESRRESTORE_ADDR A:0x6003314c
y.create.l HWIO_XPU_CFG_RPM_CFG_XPU_MESYNR0_ADDR A:0x60033150
y.create.l HWIO_XPU_CFG_RPM_CFG_XPU_MESYNR1_ADDR A:0x60033154
y.create.l HWIO_XPU_CFG_RPM_CFG_XPU_MESYNR2_ADDR A:0x60033158
y.create.l HWIO_XPU_CFG_RPM_CFG_XPU_CR_ADDR A:0x60033080
y.create.l HWIO_XPU_CFG_RPM_CFG_XPU_PRTN_RACR_SHADOW_ADDR A:0x60033088
y.create.l HWIO_XPU_CFG_RPM_CFG_XPU_PRTN_WACR_SHADOW_ADDR A:0x6003308c
y.create.l HWIO_XPU_CFG_RPM_CFG_XPU_PRTN_START_SHADOW0_ADDR A:0x60033090
y.create.l HWIO_XPU_CFG_RPM_CFG_XPU_PRTN_END_SHADOW0_ADDR A:0x60033098
y.create.l HWIO_XPU_CFG_RPM_CFG_XPU_RPU_ACR0_ADDR A:0x600330a0
y.create.l HWIO_XPU_CFG_RPM_CFG_XPU_EAR0_ADDR A:0x600330c0
y.create.l HWIO_XPU_CFG_RPM_CFG_XPU_ESR_ADDR A:0x600330c8
y.create.l HWIO_XPU_CFG_RPM_CFG_XPU_ESRRESTORE_ADDR A:0x600330cc
y.create.l HWIO_XPU_CFG_RPM_CFG_XPU_ESYNR0_ADDR A:0x600330d0
y.create.l HWIO_XPU_CFG_RPM_CFG_XPU_ESYNR1_ADDR A:0x600330d4
y.create.l HWIO_XPU_CFG_RPM_CFG_XPU_ESYNR2_ADDR A:0x600330d8
y.create.l HWIO_XPU_CFG_RPM_CFG_XPU_UMR_RACR_ADDR A:0x600330e0
y.create.l HWIO_XPU_CFG_RPM_CFG_XPU_UMR_WACR_ADDR A:0x600330e4
y.create.l HWIO_XPU_CFG_RPM_CFG_XPU_UMR_CNTL_ADDR A:0x600330f0
y.create.l HWIO_XPU_CFG_RPM_CFG_XPU_IDR0_ADDR A:0x60033074
y.create.l HWIO_XPU_CFG_RPM_CFG_XPU_IDR1_ADDR A:0x60033078
y.create.l HWIO_XPU_CFG_RPM_CFG_XPU_REV_ADDR A:0x6003307c
y.create.l HWIO_XPU_CFG_RPM_CFG_XPU_PRT0_RACR0_ADDR A:0x60033200
y.create.l HWIO_XPU_CFG_RPM_CFG_XPU_PRT1_RACR0_ADDR A:0x60033280
y.create.l HWIO_XPU_CFG_RPM_CFG_XPU_PRT0_WACR0_ADDR A:0x60033220
y.create.l HWIO_XPU_CFG_RPM_CFG_XPU_PRT1_WACR0_ADDR A:0x600332a0
y.create.l HWIO_XPU_CFG_RPM_CFG_XPU_PRT0_START0_ADDR A:0x60033240
y.create.l HWIO_XPU_CFG_RPM_CFG_XPU_PRT1_START0_ADDR A:0x600332c0
y.create.l HWIO_XPU_CFG_RPM_CFG_XPU_PRT0_END0_ADDR A:0x60033248
y.create.l HWIO_XPU_CFG_RPM_CFG_XPU_PRT1_END0_ADDR A:0x600332c8
y.create.l HWIO_XPU_CFG_RPM_CFG_XPU_PRT0_SCR_ADDR A:0x60033250
y.create.l HWIO_XPU_CFG_RPM_CFG_XPU_PRT1_SCR_ADDR A:0x600332d0
y.create.l HWIO_XPU_CFG_RPM_CFG_XPU_PRT0_MCR_ADDR A:0x60033254
y.create.l HWIO_XPU_CFG_RPM_CFG_XPU_PRT1_MCR_ADDR A:0x600332d4
y.create.l HWIO_XPU_CFG_RPM_CFG_XPU_PRT0_CNTL0_ADDR A:0x60033258
y.create.l HWIO_XPU_CFG_RPM_CFG_XPU_PRT1_CNTL0_ADDR A:0x600332d8
y.create.l HWIO_XPU_CFG_RPM_CFG_XPU_PRT0_CNTL1_ADDR A:0x6003325c
y.create.l HWIO_XPU_CFG_RPM_CFG_XPU_PRT1_CNTL1_ADDR A:0x600332dc
y.create.l HWIO_XPU_CFG_SNOC_CFG_XPU_SCR_ADDR A:0x6002d000
y.create.l HWIO_XPU_CFG_SNOC_CFG_XPU_SWDR_ADDR A:0x6002d004
y.create.l HWIO_XPU_CFG_SNOC_CFG_XPU_PRTN_RACR_SSHADOW_ADDR A:0x6002d008
y.create.l HWIO_XPU_CFG_SNOC_CFG_XPU_PRTN_WACR_SSHADOW_ADDR A:0x6002d00c
y.create.l HWIO_XPU_CFG_SNOC_CFG_XPU_PRTN_START_SSHADOW0_ADDR A:0x6002d010
y.create.l HWIO_XPU_CFG_SNOC_CFG_XPU_PRTN_END_SSHADOW0_ADDR A:0x6002d018
y.create.l HWIO_XPU_CFG_SNOC_CFG_XPU_SEAR0_ADDR A:0x6002d040
y.create.l HWIO_XPU_CFG_SNOC_CFG_XPU_SESR_ADDR A:0x6002d048
y.create.l HWIO_XPU_CFG_SNOC_CFG_XPU_SESRRESTORE_ADDR A:0x6002d04c
y.create.l HWIO_XPU_CFG_SNOC_CFG_XPU_SESYNR0_ADDR A:0x6002d050
y.create.l HWIO_XPU_CFG_SNOC_CFG_XPU_SESYNR1_ADDR A:0x6002d054
y.create.l HWIO_XPU_CFG_SNOC_CFG_XPU_SESYNR2_ADDR A:0x6002d058
y.create.l HWIO_XPU_CFG_SNOC_CFG_XPU_MCR_ADDR A:0x6002d100
y.create.l HWIO_XPU_CFG_SNOC_CFG_XPU_MEAR0_ADDR A:0x6002d140
y.create.l HWIO_XPU_CFG_SNOC_CFG_XPU_MESR_ADDR A:0x6002d148
y.create.l HWIO_XPU_CFG_SNOC_CFG_XPU_MESRRESTORE_ADDR A:0x6002d14c
y.create.l HWIO_XPU_CFG_SNOC_CFG_XPU_MESYNR0_ADDR A:0x6002d150
y.create.l HWIO_XPU_CFG_SNOC_CFG_XPU_MESYNR1_ADDR A:0x6002d154
y.create.l HWIO_XPU_CFG_SNOC_CFG_XPU_MESYNR2_ADDR A:0x6002d158
y.create.l HWIO_XPU_CFG_SNOC_CFG_XPU_CR_ADDR A:0x6002d080
y.create.l HWIO_XPU_CFG_SNOC_CFG_XPU_PRTN_RACR_SHADOW_ADDR A:0x6002d088
y.create.l HWIO_XPU_CFG_SNOC_CFG_XPU_PRTN_WACR_SHADOW_ADDR A:0x6002d08c
y.create.l HWIO_XPU_CFG_SNOC_CFG_XPU_PRTN_START_SHADOW0_ADDR A:0x6002d090
y.create.l HWIO_XPU_CFG_SNOC_CFG_XPU_PRTN_END_SHADOW0_ADDR A:0x6002d098
y.create.l HWIO_XPU_CFG_SNOC_CFG_XPU_RPU_ACR0_ADDR A:0x6002d0a0
y.create.l HWIO_XPU_CFG_SNOC_CFG_XPU_EAR0_ADDR A:0x6002d0c0
y.create.l HWIO_XPU_CFG_SNOC_CFG_XPU_ESR_ADDR A:0x6002d0c8
y.create.l HWIO_XPU_CFG_SNOC_CFG_XPU_ESRRESTORE_ADDR A:0x6002d0cc
y.create.l HWIO_XPU_CFG_SNOC_CFG_XPU_ESYNR0_ADDR A:0x6002d0d0
y.create.l HWIO_XPU_CFG_SNOC_CFG_XPU_ESYNR1_ADDR A:0x6002d0d4
y.create.l HWIO_XPU_CFG_SNOC_CFG_XPU_ESYNR2_ADDR A:0x6002d0d8
y.create.l HWIO_XPU_CFG_SNOC_CFG_XPU_UMR_RACR_ADDR A:0x6002d0e0
y.create.l HWIO_XPU_CFG_SNOC_CFG_XPU_UMR_WACR_ADDR A:0x6002d0e4
y.create.l HWIO_XPU_CFG_SNOC_CFG_XPU_UMR_CNTL_ADDR A:0x6002d0f0
y.create.l HWIO_XPU_CFG_SNOC_CFG_XPU_IDR0_ADDR A:0x6002d074
y.create.l HWIO_XPU_CFG_SNOC_CFG_XPU_IDR1_ADDR A:0x6002d078
y.create.l HWIO_XPU_CFG_SNOC_CFG_XPU_REV_ADDR A:0x6002d07c
y.create.l HWIO_XPU_CFG_SNOC_CFG_XPU_PRT0_RACR0_ADDR A:0x6002d200
y.create.l HWIO_XPU_CFG_SNOC_CFG_XPU_PRT1_RACR0_ADDR A:0x6002d280
y.create.l HWIO_XPU_CFG_SNOC_CFG_XPU_PRT2_RACR0_ADDR A:0x6002d300
y.create.l HWIO_XPU_CFG_SNOC_CFG_XPU_PRT3_RACR0_ADDR A:0x6002d380
y.create.l HWIO_XPU_CFG_SNOC_CFG_XPU_PRT0_WACR0_ADDR A:0x6002d220
y.create.l HWIO_XPU_CFG_SNOC_CFG_XPU_PRT1_WACR0_ADDR A:0x6002d2a0
y.create.l HWIO_XPU_CFG_SNOC_CFG_XPU_PRT2_WACR0_ADDR A:0x6002d320
y.create.l HWIO_XPU_CFG_SNOC_CFG_XPU_PRT3_WACR0_ADDR A:0x6002d3a0
y.create.l HWIO_XPU_CFG_SNOC_CFG_XPU_PRT0_START0_ADDR A:0x6002d240
y.create.l HWIO_XPU_CFG_SNOC_CFG_XPU_PRT1_START0_ADDR A:0x6002d2c0
y.create.l HWIO_XPU_CFG_SNOC_CFG_XPU_PRT2_START0_ADDR A:0x6002d340
y.create.l HWIO_XPU_CFG_SNOC_CFG_XPU_PRT3_START0_ADDR A:0x6002d3c0
y.create.l HWIO_XPU_CFG_SNOC_CFG_XPU_PRT0_END0_ADDR A:0x6002d248
y.create.l HWIO_XPU_CFG_SNOC_CFG_XPU_PRT1_END0_ADDR A:0x6002d2c8
y.create.l HWIO_XPU_CFG_SNOC_CFG_XPU_PRT2_END0_ADDR A:0x6002d348
y.create.l HWIO_XPU_CFG_SNOC_CFG_XPU_PRT3_END0_ADDR A:0x6002d3c8
y.create.l HWIO_XPU_CFG_SNOC_CFG_XPU_PRT0_SCR_ADDR A:0x6002d250
y.create.l HWIO_XPU_CFG_SNOC_CFG_XPU_PRT1_SCR_ADDR A:0x6002d2d0
y.create.l HWIO_XPU_CFG_SNOC_CFG_XPU_PRT2_SCR_ADDR A:0x6002d350
y.create.l HWIO_XPU_CFG_SNOC_CFG_XPU_PRT3_SCR_ADDR A:0x6002d3d0
y.create.l HWIO_XPU_CFG_SNOC_CFG_XPU_PRT0_MCR_ADDR A:0x6002d254
y.create.l HWIO_XPU_CFG_SNOC_CFG_XPU_PRT1_MCR_ADDR A:0x6002d2d4
y.create.l HWIO_XPU_CFG_SNOC_CFG_XPU_PRT2_MCR_ADDR A:0x6002d354
y.create.l HWIO_XPU_CFG_SNOC_CFG_XPU_PRT3_MCR_ADDR A:0x6002d3d4
y.create.l HWIO_XPU_CFG_SNOC_CFG_XPU_PRT0_CNTL0_ADDR A:0x6002d258
y.create.l HWIO_XPU_CFG_SNOC_CFG_XPU_PRT1_CNTL0_ADDR A:0x6002d2d8
y.create.l HWIO_XPU_CFG_SNOC_CFG_XPU_PRT2_CNTL0_ADDR A:0x6002d358
y.create.l HWIO_XPU_CFG_SNOC_CFG_XPU_PRT3_CNTL0_ADDR A:0x6002d3d8
y.create.l HWIO_XPU_CFG_SNOC_CFG_XPU_PRT0_CNTL1_ADDR A:0x6002d25c
y.create.l HWIO_XPU_CFG_SNOC_CFG_XPU_PRT1_CNTL1_ADDR A:0x6002d2dc
y.create.l HWIO_XPU_CFG_SNOC_CFG_XPU_PRT2_CNTL1_ADDR A:0x6002d35c
y.create.l HWIO_XPU_CFG_SNOC_CFG_XPU_PRT3_CNTL1_ADDR A:0x6002d3dc
y.create.done
