y.create.l HWIO_APCS_GICD_CTLR_ADDR A:0x6b000000
y.create.l HWIO_APCS_GICD_TYPER_ADDR A:0x6b000004
y.create.l HWIO_APCS_GICD_IIDR_ADDR A:0x6b000008
y.create.l HWIO_APCS_GICD_ANSACR_ADDR A:0x6b000020
y.create.l HWIO_APCS_GICD_CGCR_ADDR A:0x6b000024
y.create.l HWIO_APCS_GICD_HW_VERSION_ADDR A:0x6b000030
y.create.l HWIO_APCS_GICD_ISR0_ADDR A:0x6b000080
y.create.l HWIO_APCS_GICD_ISR1_ADDR A:0x6b000084
y.create.l HWIO_APCS_GICD_ISR2_ADDR A:0x6b000088
y.create.l HWIO_APCS_GICD_ISR3_ADDR A:0x6b00008c
y.create.l HWIO_APCS_GICD_ISR4_ADDR A:0x6b000090
y.create.l HWIO_APCS_GICD_ISR5_ADDR A:0x6b000094
y.create.l HWIO_APCS_GICD_ISR6_ADDR A:0x6b000098
y.create.l HWIO_APCS_GICD_ISR7_ADDR A:0x6b00009c
y.create.l HWIO_APCS_GICD_ISR8_ADDR A:0x6b0000a0
y.create.l HWIO_APCS_GICD_ISENABLER0_ADDR A:0x6b000100
y.create.l HWIO_APCS_GICD_ISENABLER1_ADDR A:0x6b000104
y.create.l HWIO_APCS_GICD_ISENABLER2_ADDR A:0x6b000108
y.create.l HWIO_APCS_GICD_ISENABLER3_ADDR A:0x6b00010c
y.create.l HWIO_APCS_GICD_ISENABLER4_ADDR A:0x6b000110
y.create.l HWIO_APCS_GICD_ISENABLER5_ADDR A:0x6b000114
y.create.l HWIO_APCS_GICD_ISENABLER6_ADDR A:0x6b000118
y.create.l HWIO_APCS_GICD_ISENABLER7_ADDR A:0x6b00011c
y.create.l HWIO_APCS_GICD_ISENABLER8_ADDR A:0x6b000120
y.create.l HWIO_APCS_GICD_ICENABLER0_ADDR A:0x6b000180
y.create.l HWIO_APCS_GICD_ICENABLER1_ADDR A:0x6b000184
y.create.l HWIO_APCS_GICD_ICENABLER2_ADDR A:0x6b000188
y.create.l HWIO_APCS_GICD_ICENABLER3_ADDR A:0x6b00018c
y.create.l HWIO_APCS_GICD_ICENABLER4_ADDR A:0x6b000190
y.create.l HWIO_APCS_GICD_ICENABLER5_ADDR A:0x6b000194
y.create.l HWIO_APCS_GICD_ICENABLER6_ADDR A:0x6b000198
y.create.l HWIO_APCS_GICD_ICENABLER7_ADDR A:0x6b00019c
y.create.l HWIO_APCS_GICD_ICENABLER8_ADDR A:0x6b0001a0
y.create.l HWIO_APCS_GICD_ISPENDR0_ADDR A:0x6b000200
y.create.l HWIO_APCS_GICD_ISPENDR1_ADDR A:0x6b000204
y.create.l HWIO_APCS_GICD_ISPENDR2_ADDR A:0x6b000208
y.create.l HWIO_APCS_GICD_ISPENDR3_ADDR A:0x6b00020c
y.create.l HWIO_APCS_GICD_ISPENDR4_ADDR A:0x6b000210
y.create.l HWIO_APCS_GICD_ISPENDR5_ADDR A:0x6b000214
y.create.l HWIO_APCS_GICD_ISPENDR6_ADDR A:0x6b000218
y.create.l HWIO_APCS_GICD_ISPENDR7_ADDR A:0x6b00021c
y.create.l HWIO_APCS_GICD_ISPENDR8_ADDR A:0x6b000220
y.create.l HWIO_APCS_GICD_ICPENDR0_ADDR A:0x6b000280
y.create.l HWIO_APCS_GICD_ICPENDR1_ADDR A:0x6b000284
y.create.l HWIO_APCS_GICD_ICPENDR2_ADDR A:0x6b000288
y.create.l HWIO_APCS_GICD_ICPENDR3_ADDR A:0x6b00028c
y.create.l HWIO_APCS_GICD_ICPENDR4_ADDR A:0x6b000290
y.create.l HWIO_APCS_GICD_ICPENDR5_ADDR A:0x6b000294
y.create.l HWIO_APCS_GICD_ICPENDR6_ADDR A:0x6b000298
y.create.l HWIO_APCS_GICD_ICPENDR7_ADDR A:0x6b00029c
y.create.l HWIO_APCS_GICD_ICPENDR8_ADDR A:0x6b0002a0
y.create.l HWIO_APCS_GICD_ISACTIVER0_ADDR A:0x6b000300
y.create.l HWIO_APCS_GICD_ISACTIVER1_ADDR A:0x6b000304
y.create.l HWIO_APCS_GICD_ISACTIVER2_ADDR A:0x6b000308
y.create.l HWIO_APCS_GICD_ISACTIVER3_ADDR A:0x6b00030c
y.create.l HWIO_APCS_GICD_ISACTIVER4_ADDR A:0x6b000310
y.create.l HWIO_APCS_GICD_ISACTIVER5_ADDR A:0x6b000314
y.create.l HWIO_APCS_GICD_ISACTIVER6_ADDR A:0x6b000318
y.create.l HWIO_APCS_GICD_ISACTIVER7_ADDR A:0x6b00031c
y.create.l HWIO_APCS_GICD_ISACTIVER8_ADDR A:0x6b000320
y.create.l HWIO_APCS_GICD_ICACTIVER0_ADDR A:0x6b000380
y.create.l HWIO_APCS_GICD_ICACTIVER1_ADDR A:0x6b000384
y.create.l HWIO_APCS_GICD_ICACTIVER2_ADDR A:0x6b000388
y.create.l HWIO_APCS_GICD_ICACTIVER3_ADDR A:0x6b00038c
y.create.l HWIO_APCS_GICD_ICACTIVER4_ADDR A:0x6b000390
y.create.l HWIO_APCS_GICD_ICACTIVER5_ADDR A:0x6b000394
y.create.l HWIO_APCS_GICD_ICACTIVER6_ADDR A:0x6b000398
y.create.l HWIO_APCS_GICD_ICACTIVER7_ADDR A:0x6b00039c
y.create.l HWIO_APCS_GICD_ICACTIVER8_ADDR A:0x6b0003a0
y.create.l HWIO_APCS_GICD_IPRIORITYR0_ADDR A:0x6b000400
y.create.l HWIO_APCS_GICD_IPRIORITYR1_ADDR A:0x6b000404
y.create.l HWIO_APCS_GICD_IPRIORITYR2_ADDR A:0x6b000408
y.create.l HWIO_APCS_GICD_IPRIORITYR3_ADDR A:0x6b00040c
y.create.l HWIO_APCS_GICD_IPRIORITYR4_ADDR A:0x6b000410
y.create.l HWIO_APCS_GICD_IPRIORITYR5_ADDR A:0x6b000414
y.create.l HWIO_APCS_GICD_IPRIORITYR6_ADDR A:0x6b000418
y.create.l HWIO_APCS_GICD_IPRIORITYR7_ADDR A:0x6b00041c
y.create.l HWIO_APCS_GICD_IPRIORITYR8_ADDR A:0x6b000420
y.create.l HWIO_APCS_GICD_IPRIORITYR9_ADDR A:0x6b000424
y.create.l HWIO_APCS_GICD_ITARGETSR0_ADDR A:0x6b000800
y.create.l HWIO_APCS_GICD_ITARGETSR1_ADDR A:0x6b000804
y.create.l HWIO_APCS_GICD_ITARGETSR2_ADDR A:0x6b000808
y.create.l HWIO_APCS_GICD_ITARGETSR3_ADDR A:0x6b00080c
y.create.l HWIO_APCS_GICD_ITARGETSR4_ADDR A:0x6b000810
y.create.l HWIO_APCS_GICD_ITARGETSR5_ADDR A:0x6b000814
y.create.l HWIO_APCS_GICD_ITARGETSR6_ADDR A:0x6b000818
y.create.l HWIO_APCS_GICD_ITARGETSR7_ADDR A:0x6b00081c
y.create.l HWIO_APCS_GICD_ITARGETSR8_ADDR A:0x6b000820
y.create.l HWIO_APCS_GICD_ITARGETSR9_ADDR A:0x6b000824
y.create.l HWIO_APCS_GICD_ICFGR0_ADDR A:0x6b000c00
y.create.l HWIO_APCS_GICD_ICFGR1_ADDR A:0x6b000c04
y.create.l HWIO_APCS_GICD_ICFGR2_ADDR A:0x6b000c08
y.create.l HWIO_APCS_GICD_ICFGR3_ADDR A:0x6b000c0c
y.create.l HWIO_APCS_GICD_ICFGR4_ADDR A:0x6b000c10
y.create.l HWIO_APCS_GICD_ICFGR5_ADDR A:0x6b000c14
y.create.l HWIO_APCS_GICD_ICFGR6_ADDR A:0x6b000c18
y.create.l HWIO_APCS_GICD_ICFGR7_ADDR A:0x6b000c1c
y.create.l HWIO_APCS_GICD_ICFGR8_ADDR A:0x6b000c20
y.create.l HWIO_APCS_GICD_ICFGR9_ADDR A:0x6b000c24
y.create.l HWIO_APCS_GICD_SGIR_ADDR A:0x6b000f00
y.create.l HWIO_APCS_GICD_CPENDSGIR0_ADDR A:0x6b000f10
y.create.l HWIO_APCS_GICD_CPENDSGIR1_ADDR A:0x6b000f14
y.create.l HWIO_APCS_GICD_CPENDSGIR2_ADDR A:0x6b000f18
y.create.l HWIO_APCS_GICD_CPENDSGIR3_ADDR A:0x6b000f1c
y.create.l HWIO_APCS_GICD_SPENDSGIR0_ADDR A:0x6b000f20
y.create.l HWIO_APCS_GICD_SPENDSGIR1_ADDR A:0x6b000f24
y.create.l HWIO_APCS_GICD_SPENDSGIR2_ADDR A:0x6b000f28
y.create.l HWIO_APCS_GICD_SPENDSGIR3_ADDR A:0x6b000f2c
y.create.l HWIO_APCS_GICD_PIDR0_ADDR A:0x6b000fd0
y.create.l HWIO_APCS_GICD_PIDR1_ADDR A:0x6b000fd4
y.create.l HWIO_APCS_GICD_PIDR2_ADDR A:0x6b000fd8
y.create.l HWIO_APCS_GICD_PIDR3_ADDR A:0x6b000fdc
y.create.l HWIO_APCS_GICD_PIDR4_ADDR A:0x6b000fe0
y.create.l HWIO_APCS_GICD_PIDR5_ADDR A:0x6b000fe4
y.create.l HWIO_APCS_GICD_PIDR6_ADDR A:0x6b000fe8
y.create.l HWIO_APCS_GICD_PIDR7_ADDR A:0x6b000fec
y.create.l HWIO_APCS_GICD_CIDR0_ADDR A:0x6b000ff0
y.create.l HWIO_APCS_GICD_CIDR1_ADDR A:0x6b000ff4
y.create.l HWIO_APCS_GICD_CIDR2_ADDR A:0x6b000ff8
y.create.l HWIO_APCS_GICD_CIDR3_ADDR A:0x6b000ffc
y.create.l HWIO_APCS_GICH_HCR_ADDR A:0x6b001000
y.create.l HWIO_APCS_GICH_VTR_ADDR A:0x6b001004
y.create.l HWIO_APCS_GICH_VMCR_ADDR A:0x6b001008
y.create.l HWIO_APCS_GICH_MISR_ADDR A:0x6b001010
y.create.l HWIO_APCS_GICH_EISR_ADDR A:0x6b001020
y.create.l HWIO_APCS_GICH_ELRSR_ADDR A:0x6b001030
y.create.l HWIO_APCS_GICH_APR_ADDR A:0x6b0010f0
y.create.l HWIO_APCS_GICH_LR0_ADDR A:0x6b001100
y.create.l HWIO_APCS_GICH_LR1_ADDR A:0x6b001104
y.create.l HWIO_APCS_GICH_LR2_ADDR A:0x6b001108
y.create.l HWIO_APCS_GICH_LR3_ADDR A:0x6b00110c
y.create.l HWIO_APCS_GICH_SW_LR_ADDR A:0x6b001120
y.create.l HWIO_APCS_GICC_CTLR_ADDR A:0x6b002000
y.create.l HWIO_APCS_GICC_PMR_ADDR A:0x6b002004
y.create.l HWIO_APCS_GICC_BPR_ADDR A:0x6b002008
y.create.l HWIO_APCS_GICC_IAR_ADDR A:0x6b00200c
y.create.l HWIO_APCS_GICC_EOIR_ADDR A:0x6b002010
y.create.l HWIO_APCS_GICC_RPR_ADDR A:0x6b002014
y.create.l HWIO_APCS_GICC_HPPIR_ADDR A:0x6b002018
y.create.l HWIO_APCS_GICC_ABPR_ADDR A:0x6b00201c
y.create.l HWIO_APCS_GICC_AIAR_ADDR A:0x6b002020
y.create.l HWIO_APCS_GICC_AEOIR_ADDR A:0x6b002024
y.create.l HWIO_APCS_GICC_AHPPIR_ADDR A:0x6b002028
y.create.l HWIO_APCS_GICC_APR_ADDR A:0x6b0020d0
y.create.l HWIO_APCS_GICC_NSAPR_ADDR A:0x6b0020e0
y.create.l HWIO_APCS_GICC_IIDR_ADDR A:0x6b0020fc
y.create.l HWIO_APCS_GICC_DIR_ADDR A:0x6b003000
y.create.l HWIO_APCS_GICV_CTLR_ADDR A:0x6b004000
y.create.l HWIO_APCS_GICV_PMR_ADDR A:0x6b004004
y.create.l HWIO_APCS_GICV_BPR_ADDR A:0x6b004008
y.create.l HWIO_APCS_GICV_IAR_ADDR A:0x6b00400c
y.create.l HWIO_APCS_GICV_EOIR_ADDR A:0x6b004010
y.create.l HWIO_APCS_GICV_RPR_ADDR A:0x6b004014
y.create.l HWIO_APCS_GICV_HPPIR_ADDR A:0x6b004018
y.create.l HWIO_APCS_GICV_ABPR_ADDR A:0x6b00401c
y.create.l HWIO_APCS_GICV_AIAR_ADDR A:0x6b004020
y.create.l HWIO_APCS_GICV_AEOIR_ADDR A:0x6b004024
y.create.l HWIO_APCS_GICV_AHPPIR_ADDR A:0x6b004028
y.create.l HWIO_APCS_GICV_APR_ADDR A:0x6b0040d0
y.create.l HWIO_APCS_GICV_IIDR_ADDR A:0x6b0040fc
y.create.l HWIO_APCS_GICV_DIR_ADDR A:0x6b005000
y.create.l HWIO_APCS_ACCSECURE_ADDR A:0x6b008000
y.create.l HWIO_APCS_CPU_PWR_CTL_ADDR A:0x6b008004
y.create.l HWIO_APCS_ACC_STS_ADDR A:0x6b008008
y.create.l HWIO_APCS_ATSTBUS_SEL_ADDR A:0x6b00800c
y.create.l HWIO_APCS_CPU_TRGTD_DBG_RST_ADDR A:0x6b008010
y.create.l HWIO_APCS_CPU_AUX_CLK_SEL_ADDR A:0x6b008014
y.create.l HWIO_APCS_CPU_PLL_MODE_ADDR A:0x6b008018
y.create.l HWIO_APCS_CPU_PLL_L_VAL_ADDR A:0x6b00801c
y.create.l HWIO_APCS_CPU_PLL_ALPHA_VAL_ADDR A:0x6b008020
y.create.l HWIO_APCS_CPU_PLL_ALPHA_VAL_U_ADDR A:0x6b008024
y.create.l HWIO_APCS_CPU_PLL_USER_CTL_ADDR A:0x6b008028
y.create.l HWIO_APCS_CPU_PLL_USER_CTL_U_ADDR A:0x6b00802c
y.create.l HWIO_APCS_CPU_PLL_CONFIG_CTL_ADDR A:0x6b008030
y.create.l HWIO_APCS_CPU_PLL_TEST_CTL_ADDR A:0x6b008034
y.create.l HWIO_APCS_CPU_PLL_TEST_CTL_U_ADDR A:0x6b008038
y.create.l HWIO_APCS_CPU_PLL_STATUS_ADDR A:0x6b00803c
y.create.l HWIO_APCS_CPU_PLL_FREQ_CTL_ADDR A:0x6b008040
y.create.l HWIO_APCS_TZIPC_INTERRUPT_ADDR A:0x6b008044
y.create.l HWIO_APCS_A7_CFG_ADDR A:0x6b008048
y.create.l HWIO_GCC_DBG_CLK_ON_REQ_ADDR A:0x6b00804c
y.create.l HWIO_APCS_SAW2_SECURE_ADDR A:0x6b009000
y.create.l HWIO_APCS_SAW2_ID_ADDR A:0x6b009004
y.create.l HWIO_APCS_SAW2_CFG_ADDR A:0x6b009008
y.create.l HWIO_APCS_SAW2_SPM_STS_ADDR A:0x6b00900c
y.create.l HWIO_APCS_SAW2_AVS_STS_ADDR A:0x6b009010
y.create.l HWIO_APCS_SAW2_PMIC_STS_ADDR A:0x6b009014
y.create.l HWIO_APCS_SAW2_RST_ADDR A:0x6b009018
y.create.l HWIO_APCS_SAW2_SPM_CTL_ADDR A:0x6b009030
y.create.l HWIO_APCS_SAW2_SPM_DLY_ADDR A:0x6b009034
y.create.l HWIO_APCS_SAW2_SPM_STS2_ADDR A:0x6b009038
y.create.l HWIO_APCS_SAW2_SPM_SLP_SEQ_ENTRY_0_ADDR A:0x6b009400
y.create.l HWIO_APCS_SAW2_SPM_SLP_SEQ_ENTRY_1_ADDR A:0x6b009404
y.create.l HWIO_APCS_SAW2_SPM_SLP_SEQ_ENTRY_2_ADDR A:0x6b009408
y.create.l HWIO_APCS_SAW2_SPM_SLP_SEQ_ENTRY_3_ADDR A:0x6b00940c
y.create.l HWIO_APCS_SAW2_SPM_SLP_SEQ_ENTRY_4_ADDR A:0x6b009410
y.create.l HWIO_APCS_SAW2_SPM_SLP_SEQ_ENTRY_5_ADDR A:0x6b009414
y.create.l HWIO_APCS_SAW2_SPM_SLP_SEQ_ENTRY_6_ADDR A:0x6b009418
y.create.l HWIO_APCS_SAW2_SPM_SLP_SEQ_ENTRY_7_ADDR A:0x6b00941c
y.create.l HWIO_APCS_SAW2_SPM_SLP_SEQ_ENTRY_8_ADDR A:0x6b009420
y.create.l HWIO_APCS_SAW2_SPM_SLP_SEQ_ENTRY_9_ADDR A:0x6b009424
y.create.l HWIO_APCS_SAW2_SPM_PMIC_DATA_0_ADDR A:0x6b009040
y.create.l HWIO_APCS_SAW2_SPM_PMIC_DATA_1_ADDR A:0x6b009044
y.create.l HWIO_APCS_SAW2_VERSION_ADDR A:0x6b009fd0
y.create.l HWIO_QTMR_AC_CNTFRQ_ADDR A:0x6b020000
y.create.l HWIO_QTMR_AC_CNTSR_ADDR A:0x6b020004
y.create.l HWIO_QTMR_AC_CNTTID_ADDR A:0x6b020008
y.create.l HWIO_QTMR_AC_CNTACR_0_ADDR A:0x6b020040
y.create.l HWIO_QTMR_AC_CNTACR_1_ADDR A:0x6b020044
y.create.l HWIO_QTMR_AC_CNTACR_2_ADDR A:0x6b020048
y.create.l HWIO_QTMR_AC_CNTACR_3_ADDR A:0x6b02004c
y.create.l HWIO_QTMR_AC_CNTACR_4_ADDR A:0x6b020050
y.create.l HWIO_QTMR_AC_CNTACR_5_ADDR A:0x6b020054
y.create.l HWIO_QTMR_AC_CNTACR_6_ADDR A:0x6b020058
y.create.l HWIO_QTMR_AC_CNTACR_7_ADDR A:0x6b02005c
y.create.l HWIO_QTMR_AC_CNTVOFF_LO_0_ADDR A:0x6b020080
y.create.l HWIO_QTMR_AC_CNTVOFF_LO_1_ADDR A:0x6b020088
y.create.l HWIO_QTMR_AC_CNTVOFF_LO_2_ADDR A:0x6b020090
y.create.l HWIO_QTMR_AC_CNTVOFF_LO_3_ADDR A:0x6b020098
y.create.l HWIO_QTMR_AC_CNTVOFF_LO_4_ADDR A:0x6b0200a0
y.create.l HWIO_QTMR_AC_CNTVOFF_LO_5_ADDR A:0x6b0200a8
y.create.l HWIO_QTMR_AC_CNTVOFF_LO_6_ADDR A:0x6b0200b0
y.create.l HWIO_QTMR_AC_CNTVOFF_LO_7_ADDR A:0x6b0200b8
y.create.l HWIO_QTMR_AC_CNTVOFF_HI_0_ADDR A:0x6b020084
y.create.l HWIO_QTMR_AC_CNTVOFF_HI_1_ADDR A:0x6b02008c
y.create.l HWIO_QTMR_AC_CNTVOFF_HI_2_ADDR A:0x6b020094
y.create.l HWIO_QTMR_AC_CNTVOFF_HI_3_ADDR A:0x6b02009c
y.create.l HWIO_QTMR_AC_CNTVOFF_HI_4_ADDR A:0x6b0200a4
y.create.l HWIO_QTMR_AC_CNTVOFF_HI_5_ADDR A:0x6b0200ac
y.create.l HWIO_QTMR_AC_CNTVOFF_HI_6_ADDR A:0x6b0200b4
y.create.l HWIO_QTMR_AC_CNTVOFF_HI_7_ADDR A:0x6b0200bc
y.create.l HWIO_QTMR_AC_CFG_ADDR A:0x6b020fc0
y.create.l HWIO_QTMR_AC_VERSION_ADDR A:0x6b020fd0
y.create.l HWIO_APCS_F0_QTMR_V1_CNTPCT_LO_ADDR A:0x6b021000
y.create.l HWIO_APCS_F0_QTMR_V1_CNTPCT_HI_ADDR A:0x6b021004
y.create.l HWIO_APCS_F0_QTMR_V1_CNTVCT_LO_ADDR A:0x6b021008
y.create.l HWIO_APCS_F0_QTMR_V1_CNTVCT_HI_ADDR A:0x6b02100c
y.create.l HWIO_APCS_F0_QTMR_V1_CNTFRQ_ADDR A:0x6b021010
y.create.l HWIO_APCS_F0_QTMR_V1_CNTPL0ACR_ADDR A:0x6b021014
y.create.l HWIO_APCS_F0_QTMR_V1_CNTVOFF_LO_ADDR A:0x6b021018
y.create.l HWIO_APCS_F0_QTMR_V1_CNTVOFF_HI_ADDR A:0x6b02101c
y.create.l HWIO_APCS_F0_QTMR_V1_CNTP_CVAL_LO_ADDR A:0x6b021020
y.create.l HWIO_APCS_F0_QTMR_V1_CNTP_CVAL_HI_ADDR A:0x6b021024
y.create.l HWIO_APCS_F0_QTMR_V1_CNTP_TVAL_ADDR A:0x6b021028
y.create.l HWIO_APCS_F0_QTMR_V1_CNTP_CTL_ADDR A:0x6b02102c
y.create.l HWIO_APCS_F0_QTMR_V1_CNTV_CVAL_LO_ADDR A:0x6b021030
y.create.l HWIO_APCS_F0_QTMR_V1_CNTV_CVAL_HI_ADDR A:0x6b021034
y.create.l HWIO_APCS_F0_QTMR_V1_CNTV_TVAL_ADDR A:0x6b021038
y.create.l HWIO_APCS_F0_QTMR_V1_CNTV_CTL_ADDR A:0x6b02103c
y.create.l HWIO_APCS_F0_QTMR_V1_VERSION_ADDR A:0x6b021fd0
y.create.l HWIO_APCS_F0_QTMR_V2_CNTPCT_LO_ADDR A:0x6b022000
y.create.l HWIO_APCS_F0_QTMR_V2_CNTPCT_HI_ADDR A:0x6b022004
y.create.l HWIO_APCS_F0_QTMR_V2_CNTVCT_LO_ADDR A:0x6b022008
y.create.l HWIO_APCS_F0_QTMR_V2_CNTVCT_HI_ADDR A:0x6b02200c
y.create.l HWIO_APCS_F0_QTMR_V2_CNTFRQ_ADDR A:0x6b022010
y.create.l HWIO_APCS_F0_QTMR_V2_CNTP_CVAL_LO_ADDR A:0x6b022020
y.create.l HWIO_APCS_F0_QTMR_V2_CNTP_CVAL_HI_ADDR A:0x6b022024
y.create.l HWIO_APCS_F0_QTMR_V2_CNTP_TVAL_ADDR A:0x6b022028
y.create.l HWIO_APCS_F0_QTMR_V2_CNTP_CTL_ADDR A:0x6b02202c
y.create.l HWIO_APCS_F0_QTMR_V2_CNTV_CVAL_LO_ADDR A:0x6b022030
y.create.l HWIO_APCS_F0_QTMR_V2_CNTV_CVAL_HI_ADDR A:0x6b022034
y.create.l HWIO_APCS_F0_QTMR_V2_CNTV_TVAL_ADDR A:0x6b022038
y.create.l HWIO_APCS_F0_QTMR_V2_CNTV_CTL_ADDR A:0x6b02203c
y.create.l HWIO_APCS_F0_QTMR_V2_VERSION_ADDR A:0x6b022fd0
y.create.l HWIO_APCS_F1_QTMR_V1_CNTPCT_LO_ADDR A:0x6b023000
y.create.l HWIO_APCS_F1_QTMR_V1_CNTPCT_HI_ADDR A:0x6b023004
y.create.l HWIO_APCS_F1_QTMR_V1_CNTVCT_LO_ADDR A:0x6b023008
y.create.l HWIO_APCS_F1_QTMR_V1_CNTVCT_HI_ADDR A:0x6b02300c
y.create.l HWIO_APCS_F1_QTMR_V1_CNTFRQ_ADDR A:0x6b023010
y.create.l HWIO_APCS_F1_QTMR_V1_CNTPL0ACR_ADDR A:0x6b023014
y.create.l HWIO_APCS_F1_QTMR_V1_CNTVOFF_LO_ADDR A:0x6b023018
y.create.l HWIO_APCS_F1_QTMR_V1_CNTVOFF_HI_ADDR A:0x6b02301c
y.create.l HWIO_APCS_F1_QTMR_V1_CNTP_CVAL_LO_ADDR A:0x6b023020
y.create.l HWIO_APCS_F1_QTMR_V1_CNTP_CVAL_HI_ADDR A:0x6b023024
y.create.l HWIO_APCS_F1_QTMR_V1_CNTP_TVAL_ADDR A:0x6b023028
y.create.l HWIO_APCS_F1_QTMR_V1_CNTP_CTL_ADDR A:0x6b02302c
y.create.l HWIO_APCS_F1_QTMR_V1_CNTV_CVAL_LO_ADDR A:0x6b023030
y.create.l HWIO_APCS_F1_QTMR_V1_CNTV_CVAL_HI_ADDR A:0x6b023034
y.create.l HWIO_APCS_F1_QTMR_V1_CNTV_TVAL_ADDR A:0x6b023038
y.create.l HWIO_APCS_F1_QTMR_V1_CNTV_CTL_ADDR A:0x6b02303c
y.create.l HWIO_APCS_F1_QTMR_V1_VERSION_ADDR A:0x6b023fd0
y.create.l HWIO_APCS_F2_QTMR_V1_CNTPCT_LO_ADDR A:0x6b024000
y.create.l HWIO_APCS_F2_QTMR_V1_CNTPCT_HI_ADDR A:0x6b024004
y.create.l HWIO_APCS_F2_QTMR_V1_CNTVCT_LO_ADDR A:0x6b024008
y.create.l HWIO_APCS_F2_QTMR_V1_CNTVCT_HI_ADDR A:0x6b02400c
y.create.l HWIO_APCS_F2_QTMR_V1_CNTFRQ_ADDR A:0x6b024010
y.create.l HWIO_APCS_F2_QTMR_V1_CNTPL0ACR_ADDR A:0x6b024014
y.create.l HWIO_APCS_F2_QTMR_V1_CNTVOFF_LO_ADDR A:0x6b024018
y.create.l HWIO_APCS_F2_QTMR_V1_CNTVOFF_HI_ADDR A:0x6b02401c
y.create.l HWIO_APCS_F2_QTMR_V1_CNTP_CVAL_LO_ADDR A:0x6b024020
y.create.l HWIO_APCS_F2_QTMR_V1_CNTP_CVAL_HI_ADDR A:0x6b024024
y.create.l HWIO_APCS_F2_QTMR_V1_CNTP_TVAL_ADDR A:0x6b024028
y.create.l HWIO_APCS_F2_QTMR_V1_CNTP_CTL_ADDR A:0x6b02402c
y.create.l HWIO_APCS_F2_QTMR_V1_CNTV_CVAL_LO_ADDR A:0x6b024030
y.create.l HWIO_APCS_F2_QTMR_V1_CNTV_CVAL_HI_ADDR A:0x6b024034
y.create.l HWIO_APCS_F2_QTMR_V1_CNTV_TVAL_ADDR A:0x6b024038
y.create.l HWIO_APCS_F2_QTMR_V1_CNTV_CTL_ADDR A:0x6b02403c
y.create.l HWIO_APCS_F2_QTMR_V1_VERSION_ADDR A:0x6b024fd0
y.create.l HWIO_APCS_F3_QTMR_V1_CNTPCT_LO_ADDR A:0x6b025000
y.create.l HWIO_APCS_F3_QTMR_V1_CNTPCT_HI_ADDR A:0x6b025004
y.create.l HWIO_APCS_F3_QTMR_V1_CNTVCT_LO_ADDR A:0x6b025008
y.create.l HWIO_APCS_F3_QTMR_V1_CNTVCT_HI_ADDR A:0x6b02500c
y.create.l HWIO_APCS_F3_QTMR_V1_CNTFRQ_ADDR A:0x6b025010
y.create.l HWIO_APCS_F3_QTMR_V1_CNTPL0ACR_ADDR A:0x6b025014
y.create.l HWIO_APCS_F3_QTMR_V1_CNTVOFF_LO_ADDR A:0x6b025018
y.create.l HWIO_APCS_F3_QTMR_V1_CNTVOFF_HI_ADDR A:0x6b02501c
y.create.l HWIO_APCS_F3_QTMR_V1_CNTP_CVAL_LO_ADDR A:0x6b025020
y.create.l HWIO_APCS_F3_QTMR_V1_CNTP_CVAL_HI_ADDR A:0x6b025024
y.create.l HWIO_APCS_F3_QTMR_V1_CNTP_TVAL_ADDR A:0x6b025028
y.create.l HWIO_APCS_F3_QTMR_V1_CNTP_CTL_ADDR A:0x6b02502c
y.create.l HWIO_APCS_F3_QTMR_V1_CNTV_CVAL_LO_ADDR A:0x6b025030
y.create.l HWIO_APCS_F3_QTMR_V1_CNTV_CVAL_HI_ADDR A:0x6b025034
y.create.l HWIO_APCS_F3_QTMR_V1_CNTV_TVAL_ADDR A:0x6b025038
y.create.l HWIO_APCS_F3_QTMR_V1_CNTV_CTL_ADDR A:0x6b02503c
y.create.l HWIO_APCS_F3_QTMR_V1_VERSION_ADDR A:0x6b025fd0
y.create.l HWIO_APCS_F4_QTMR_V1_CNTPCT_LO_ADDR A:0x6b026000
y.create.l HWIO_APCS_F4_QTMR_V1_CNTPCT_HI_ADDR A:0x6b026004
y.create.l HWIO_APCS_F4_QTMR_V1_CNTVCT_LO_ADDR A:0x6b026008
y.create.l HWIO_APCS_F4_QTMR_V1_CNTVCT_HI_ADDR A:0x6b02600c
y.create.l HWIO_APCS_F4_QTMR_V1_CNTFRQ_ADDR A:0x6b026010
y.create.l HWIO_APCS_F4_QTMR_V1_CNTPL0ACR_ADDR A:0x6b026014
y.create.l HWIO_APCS_F4_QTMR_V1_CNTVOFF_LO_ADDR A:0x6b026018
y.create.l HWIO_APCS_F4_QTMR_V1_CNTVOFF_HI_ADDR A:0x6b02601c
y.create.l HWIO_APCS_F4_QTMR_V1_CNTP_CVAL_LO_ADDR A:0x6b026020
y.create.l HWIO_APCS_F4_QTMR_V1_CNTP_CVAL_HI_ADDR A:0x6b026024
y.create.l HWIO_APCS_F4_QTMR_V1_CNTP_TVAL_ADDR A:0x6b026028
y.create.l HWIO_APCS_F4_QTMR_V1_CNTP_CTL_ADDR A:0x6b02602c
y.create.l HWIO_APCS_F4_QTMR_V1_CNTV_CVAL_LO_ADDR A:0x6b026030
y.create.l HWIO_APCS_F4_QTMR_V1_CNTV_CVAL_HI_ADDR A:0x6b026034
y.create.l HWIO_APCS_F4_QTMR_V1_CNTV_TVAL_ADDR A:0x6b026038
y.create.l HWIO_APCS_F4_QTMR_V1_CNTV_CTL_ADDR A:0x6b02603c
y.create.l HWIO_APCS_F4_QTMR_V1_VERSION_ADDR A:0x6b026fd0
y.create.l HWIO_APCS_F5_QTMR_V1_CNTPCT_LO_ADDR A:0x6b027000
y.create.l HWIO_APCS_F5_QTMR_V1_CNTPCT_HI_ADDR A:0x6b027004
y.create.l HWIO_APCS_F5_QTMR_V1_CNTVCT_LO_ADDR A:0x6b027008
y.create.l HWIO_APCS_F5_QTMR_V1_CNTVCT_HI_ADDR A:0x6b02700c
y.create.l HWIO_APCS_F5_QTMR_V1_CNTFRQ_ADDR A:0x6b027010
y.create.l HWIO_APCS_F5_QTMR_V1_CNTPL0ACR_ADDR A:0x6b027014
y.create.l HWIO_APCS_F5_QTMR_V1_CNTVOFF_LO_ADDR A:0x6b027018
y.create.l HWIO_APCS_F5_QTMR_V1_CNTVOFF_HI_ADDR A:0x6b02701c
y.create.l HWIO_APCS_F5_QTMR_V1_CNTP_CVAL_LO_ADDR A:0x6b027020
y.create.l HWIO_APCS_F5_QTMR_V1_CNTP_CVAL_HI_ADDR A:0x6b027024
y.create.l HWIO_APCS_F5_QTMR_V1_CNTP_TVAL_ADDR A:0x6b027028
y.create.l HWIO_APCS_F5_QTMR_V1_CNTP_CTL_ADDR A:0x6b02702c
y.create.l HWIO_APCS_F5_QTMR_V1_CNTV_CVAL_LO_ADDR A:0x6b027030
y.create.l HWIO_APCS_F5_QTMR_V1_CNTV_CVAL_HI_ADDR A:0x6b027034
y.create.l HWIO_APCS_F5_QTMR_V1_CNTV_TVAL_ADDR A:0x6b027038
y.create.l HWIO_APCS_F5_QTMR_V1_CNTV_CTL_ADDR A:0x6b02703c
y.create.l HWIO_APCS_F5_QTMR_V1_VERSION_ADDR A:0x6b027fd0
y.create.l HWIO_APCS_F6_QTMR_V1_CNTPCT_LO_ADDR A:0x6b028000
y.create.l HWIO_APCS_F6_QTMR_V1_CNTPCT_HI_ADDR A:0x6b028004
y.create.l HWIO_APCS_F6_QTMR_V1_CNTVCT_LO_ADDR A:0x6b028008
y.create.l HWIO_APCS_F6_QTMR_V1_CNTVCT_HI_ADDR A:0x6b02800c
y.create.l HWIO_APCS_F6_QTMR_V1_CNTFRQ_ADDR A:0x6b028010
y.create.l HWIO_APCS_F6_QTMR_V1_CNTPL0ACR_ADDR A:0x6b028014
y.create.l HWIO_APCS_F6_QTMR_V1_CNTVOFF_LO_ADDR A:0x6b028018
y.create.l HWIO_APCS_F6_QTMR_V1_CNTVOFF_HI_ADDR A:0x6b02801c
y.create.l HWIO_APCS_F6_QTMR_V1_CNTP_CVAL_LO_ADDR A:0x6b028020
y.create.l HWIO_APCS_F6_QTMR_V1_CNTP_CVAL_HI_ADDR A:0x6b028024
y.create.l HWIO_APCS_F6_QTMR_V1_CNTP_TVAL_ADDR A:0x6b028028
y.create.l HWIO_APCS_F6_QTMR_V1_CNTP_CTL_ADDR A:0x6b02802c
y.create.l HWIO_APCS_F6_QTMR_V1_CNTV_CVAL_LO_ADDR A:0x6b028030
y.create.l HWIO_APCS_F6_QTMR_V1_CNTV_CVAL_HI_ADDR A:0x6b028034
y.create.l HWIO_APCS_F6_QTMR_V1_CNTV_TVAL_ADDR A:0x6b028038
y.create.l HWIO_APCS_F6_QTMR_V1_CNTV_CTL_ADDR A:0x6b02803c
y.create.l HWIO_APCS_F6_QTMR_V1_VERSION_ADDR A:0x6b028fd0
y.create.l HWIO_APCS_F7_QTMR_V1_CNTPCT_LO_ADDR A:0x6b029000
y.create.l HWIO_APCS_F7_QTMR_V1_CNTPCT_HI_ADDR A:0x6b029004
y.create.l HWIO_APCS_F7_QTMR_V1_CNTVCT_LO_ADDR A:0x6b029008
y.create.l HWIO_APCS_F7_QTMR_V1_CNTVCT_HI_ADDR A:0x6b02900c
y.create.l HWIO_APCS_F7_QTMR_V1_CNTFRQ_ADDR A:0x6b029010
y.create.l HWIO_APCS_F7_QTMR_V1_CNTPL0ACR_ADDR A:0x6b029014
y.create.l HWIO_APCS_F7_QTMR_V1_CNTVOFF_LO_ADDR A:0x6b029018
y.create.l HWIO_APCS_F7_QTMR_V1_CNTVOFF_HI_ADDR A:0x6b02901c
y.create.l HWIO_APCS_F7_QTMR_V1_CNTP_CVAL_LO_ADDR A:0x6b029020
y.create.l HWIO_APCS_F7_QTMR_V1_CNTP_CVAL_HI_ADDR A:0x6b029024
y.create.l HWIO_APCS_F7_QTMR_V1_CNTP_TVAL_ADDR A:0x6b029028
y.create.l HWIO_APCS_F7_QTMR_V1_CNTP_CTL_ADDR A:0x6b02902c
y.create.l HWIO_APCS_F7_QTMR_V1_CNTV_CVAL_LO_ADDR A:0x6b029030
y.create.l HWIO_APCS_F7_QTMR_V1_CNTV_CVAL_HI_ADDR A:0x6b029034
y.create.l HWIO_APCS_F7_QTMR_V1_CNTV_TVAL_ADDR A:0x6b029038
y.create.l HWIO_APCS_F7_QTMR_V1_CNTV_CTL_ADDR A:0x6b02903c
y.create.l HWIO_APCS_F7_QTMR_V1_VERSION_ADDR A:0x6b029fd0
y.create.l HWIO_WDOG_SECURE_ADDR A:0x6b017000
y.create.l HWIO_WDOG_RESET_ADDR A:0x6b017004
y.create.l HWIO_WDOG_CTL_ADDR A:0x6b017008
y.create.l HWIO_WDOG_STATUS_ADDR A:0x6b01700c
y.create.l HWIO_WDOG_BARK_TIME_ADDR A:0x6b017010
y.create.l HWIO_WDOG_BITE_TIME_ADDR A:0x6b017014
y.create.l HWIO_WDOG_TEST_LOAD_STATUS_ADDR A:0x6b017018
y.create.l HWIO_WDOG_TEST_LOAD_ADDR A:0x6b01701c
y.create.l HWIO_WDOG_TEST_ADDR A:0x6b017020
y.create.l HWIO_APCS_GLBSECURE_ADDR A:0x6b010000
y.create.l HWIO_APCS_START_ADDR_ADDR A:0x6b010004
y.create.l HWIO_APCS_CMD_RCGR_ADDR A:0x6b010008
y.create.l HWIO_APCS_CFG_RCGR_ADDR A:0x6b01000c
y.create.l HWIO_APCS_CBCR_ADDR A:0x6b010010
y.create.l HWIO_APCS_GLB_CFG_ADDR A:0x6b010014
y.create.l HWIO_APCS_GLB_BOOT_REMAP_ADDR A:0x6b010018
y.create.l HWIO_APCS_GLB_TEST_BUSSEL_ADDR A:0x6b01001c
y.create.l HWIO_APCS_GLB_EN_PWR_ST_ADDR A:0x6b010020
y.create.l HWIO_APCS_GLB_QSB_LP_ADDR A:0x6b010024
y.create.l HWIO_APCS_GLB_AHB_CLKON_ADDR A:0x6b010028
y.create.l HWIO_APCS_GLB_QGIC_CFG_ADDR A:0x6b01002c
y.create.l HWIO_APCS_GLB_GHDS_CNTR_ADDR A:0x6b010030
y.create.l HWIO_APCS_TCM_REDIRECT_ADDR_ADDR A:0x6b010034
y.create.l HWIO_APCS_A7_GLB_CFG_ADDR A:0x6b010038
y.create.l HWIO_SPM_VOTE_TZ_ADDR A:0x6b01003c
y.create.l HWIO_SPM_VOTE_HLOS_ADDR A:0x6b010040
y.create.l HWIO_SPM_VOTE_HYP_ADDR A:0x6b010044
y.create.l HWIO_SPM_VOTE_INT_STS_ADDR A:0x6b010048
y.create.l HWIO_SPM_VOTE_INT_CLR_ADDR A:0x6b01004c
y.create.l HWIO_APPS_BOOTFSM_CTL_ADDR A:0x6b010050
y.create.l HWIO_APPS_BOOTFSM_STATUS_ADDR A:0x6b010054
y.create.l HWIO_RBCPR_CLK_SEL_ADDR A:0x6b010058
y.create.l HWIO_RBCPR_BCR_ADDR A:0x6b01005c
y.create.l HWIO_RBCPR_PMIC_ADDR A:0x6b010060
y.create.l HWIO_APCS_GCCSECURE_ADDR A:0x6b011000
y.create.l HWIO_APCS_IPC_SECURITY_ADDR A:0x6b011004
y.create.l HWIO_APCS_IPC_ADDR A:0x6b011008
y.create.l HWIO_APCS_PWR_CTL_OVERRIDE_ADDR A:0x6b01100c
y.create.l HWIO_APCS_GCLK_STS_ADDR A:0x6b011010
y.create.l HWIO_APCS_L2_PWR_CTL_ADDR A:0x6b011014
y.create.l HWIO_APCS_PWR_STS_ADDR A:0x6b011018
y.create.l HWIO_APCS_CLK_DIAG_ADDR A:0x6b01101c
y.create.l HWIO_APCS_ALL_TSTBUS_SEL_ADDR A:0x6b011020
y.create.l HWIO_APCS_DBG_PWR_CTL_ADDR A:0x6b011024
y.create.l HWIO_APCS_L2_AUX_CLK_SEL_ADDR A:0x6b011028
y.create.l HWIO_APCS_SPARE_ADDR A:0x6b01102c
y.create.l HWIO_APCS_SPARE_STS_ADDR A:0x6b011030
y.create.l HWIO_XPU_STATUS_ADDR A:0x6b011034
y.create.l HWIO_APCS_HW_EVENT_SEL_0_ADDR A:0x6b011038
y.create.l HWIO_APCS_HW_EVENT_SEL_1_ADDR A:0x6b01103c
y.create.l HWIO_APCS_HW_EVENT_SEL_2_ADDR A:0x6b011040
y.create.l HWIO_APCS_HW_EVENT_SEL_3_ADDR A:0x6b011044
y.create.l HWIO_APCS_HW_EVENT_SEL_4_ADDR A:0x6b011048
y.create.l HWIO_APCS_HW_EVENT_SEL_5_ADDR A:0x6b01104c
y.create.l HWIO_APCS_HW_EVENT_SEL_6_ADDR A:0x6b011050
y.create.l HWIO_APCS_HW_EVENT_SEL_7_ADDR A:0x6b011054
y.create.l HWIO_APCS_HW_EVENT_SEL_8_ADDR A:0x6b011058
y.create.l HWIO_APCS_HW_EVENT_SEL_9_ADDR A:0x6b01105c
y.create.l HWIO_APCS_RBCPR_VERSION_ADDR A:0x6b018000
y.create.l HWIO_APCS_RBCPR_SENSOR_MASK0_ADDR A:0x6b018020
y.create.l HWIO_APCS_RBCPR_SENSOR_MASK1_ADDR A:0x6b018024
y.create.l HWIO_APCS_RBCPR_SENSOR_MASK2_ADDR A:0x6b018028
y.create.l HWIO_APCS_RBCPR_SENSOR_MASK3_ADDR A:0x6b01802c
y.create.l HWIO_APCS_RBCPR_SENSOR_BYPASS0_ADDR A:0x6b018030
y.create.l HWIO_APCS_RBCPR_SENSOR_BYPASS1_ADDR A:0x6b018034
y.create.l HWIO_APCS_RBCPR_SENSOR_BYPASS2_ADDR A:0x6b018038
y.create.l HWIO_APCS_RBCPR_SENSOR_BYPASS3_ADDR A:0x6b01803c
y.create.l HWIO_APCS_RBIF_PMIC_ADDR_ADDR A:0x6b018040
y.create.l HWIO_APCS_RBCPR_TIMER_INTERVAL_ADDR A:0x6b018044
y.create.l HWIO_APCS_RBIF_LIMIT_ADDR A:0x6b018048
y.create.l HWIO_APCS_RBIF_TIMER_ADJUST_ADDR A:0x6b01804c
y.create.l HWIO_APCS_RBCPR_GCNT_TARGET0_ADDR A:0x6b018060
y.create.l HWIO_APCS_RBCPR_GCNT_TARGET1_ADDR A:0x6b018064
y.create.l HWIO_APCS_RBCPR_GCNT_TARGET2_ADDR A:0x6b018068
y.create.l HWIO_APCS_RBCPR_GCNT_TARGET3_ADDR A:0x6b01806c
y.create.l HWIO_APCS_RBCPR_GCNT_TARGET4_ADDR A:0x6b018070
y.create.l HWIO_APCS_RBCPR_GCNT_TARGET5_ADDR A:0x6b018074
y.create.l HWIO_APCS_RBCPR_GCNT_TARGET6_ADDR A:0x6b018078
y.create.l HWIO_APCS_RBCPR_GCNT_TARGET7_ADDR A:0x6b01807c
y.create.l HWIO_APCS_RBCPR_STEP_QUOT_ADDR A:0x6b018080
y.create.l HWIO_APCS_RBCPR_CTL_ADDR A:0x6b018090
y.create.l HWIO_APCS_RBIF_SW_VLEVEL_ADDR A:0x6b018094
y.create.l HWIO_APCS_RBIF_CONT_ACK_CMD_ADDR A:0x6b018098
y.create.l HWIO_APCS_RBIF_CONT_NACK_CMD_ADDR A:0x6b01809c
y.create.l HWIO_APCS_RBCPR_RESULT_0_ADDR A:0x6b0180a0
y.create.l HWIO_APCS_RBCPR_RESULT_1_ADDR A:0x6b0180a4
y.create.l HWIO_APCS_RBIF_IRQ_EN_0_ADDR A:0x6b018100
y.create.l HWIO_APCS_RBIF_IRQ_EN_1_ADDR A:0x6b018104
y.create.l HWIO_APCS_RBIF_IRQ_EN_2_ADDR A:0x6b018108
y.create.l HWIO_APCS_RBIF_IRQ_CLEAR_ADDR A:0x6b018110
y.create.l HWIO_APCS_RBIF_IRQ_STATUS_ADDR A:0x6b018114
y.create.l HWIO_APCS_RBCPR_QUOT_AVG_ADDR A:0x6b018118
y.create.l HWIO_APCS_RBCPR_DEBUG0_ADDR A:0x6b01811c
y.create.l HWIO_APCS_RBCPR_DEBUG1_ADDR A:0x6b018120
y.create.l HWIO_APCS_RBCPR_DEBUG2_ADDR A:0x6b018124
y.create.l HWIO_APCS_RBCPR_BIST_MINMAX_ADDR A:0x6b018128
y.create.l HWIO_APCS_RBCPR_BIST_RESULT_ADDR A:0x6b01812c
y.create.l HWIO_APCS_RBCPR_BIST_FAIL_MAP0_ADDR A:0x6b018130
y.create.l HWIO_APCS_RBCPR_BIST_FAIL_MAP1_ADDR A:0x6b018134
y.create.l HWIO_APCS_RBCPR_BIST_FAIL_MAP2_ADDR A:0x6b018138
y.create.l HWIO_APCS_RBCPR_BIST_FAIL_MAP3_ADDR A:0x6b01813c
y.create.l HWIO_APCS_RBCPR_LOG_0_ADDR A:0x6b018140
y.create.l HWIO_APCS_RBCPR_LOG_1_ADDR A:0x6b018144
y.create.l HWIO_APCS_RBCPR_LOG_2_ADDR A:0x6b018148
y.create.l HWIO_APCS_RBCPR_LOG_3_ADDR A:0x6b01814c
y.create.l HWIO_APCS_RBCPR_LOG_4_ADDR A:0x6b018150
y.create.l HWIO_APCS_RBCPR_LOG_5_ADDR A:0x6b018154
y.create.l HWIO_APCS_RBCPR_LOG_6_ADDR A:0x6b018158
y.create.l HWIO_APCS_RBCPR_LOG_7_ADDR A:0x6b01815c
y.create.l HWIO_APCS_RBCPR_HTOL_AGE_ADDR A:0x6b018160
y.create.l HWIO_BIMC_HW_VERSION_ADDR A:0x60400000
y.create.l HWIO_BIMC_CORE_INFO_ADDR A:0x60400004
y.create.l HWIO_BIMC_HW_INFO_ADDR A:0x60400008
y.create.l HWIO_BIMC_CORE_CLK_SEL_ADDR A:0x60400020
y.create.l HWIO_BIMC_CORE_CLK_PERIOD_ADDR A:0x60400024
y.create.l HWIO_BIMC_SCMO0_LOCAL_CGC_THRESHOLD_ADDR A:0x60400100
y.create.l HWIO_BIMC_DPE0_LOCAL_CGC_THRESHOLD_ADDR A:0x60400140
y.create.l HWIO_BIMC_MPORT_CORE_DOMAIN_LOCAL_CGC_THRESHOLD_ADDR A:0x60400180
y.create.l HWIO_BIMC_MPORT0_CLK_LOCAL_CGC_THRESHOLD_ADDR A:0x604001c0
y.create.l HWIO_BIMC_MPORT1_CLK_LOCAL_CGC_THRESHOLD_ADDR A:0x604001c4
y.create.l HWIO_BIMC_MPORT2_CLK_LOCAL_CGC_THRESHOLD_ADDR A:0x604001c8
y.create.l HWIO_BIMC_MPORT3_CLK_LOCAL_CGC_THRESHOLD_ADDR A:0x604001cc
y.create.l HWIO_BIMC_MPORT4_CLK_LOCAL_CGC_THRESHOLD_ADDR A:0x604001d0
y.create.l HWIO_BIMC_MPORT5_CLK_LOCAL_CGC_THRESHOLD_ADDR A:0x604001d4
y.create.l HWIO_BIMC_SWAY_LOCAL_CGC_THRESHOLD_ADDR A:0x60400200
y.create.l HWIO_BIMC_SCMO0_CGC_CFG_ADDR A:0x60400240
y.create.l HWIO_BIMC_DPE0_CGC_CFG_ADDR A:0x60400280
y.create.l HWIO_BIMC_CALIBRATION_CFG_ADDR A:0x60400400
y.create.l HWIO_BIMC_DFI0_LP_CFG_ADDR A:0x60400600
y.create.l HWIO_BIMC_HFSC_CFG_ADDR A:0x60400800
y.create.l HWIO_BIMC_HFSC_STATUS_ADDR A:0x6040080c
y.create.l HWIO_BIMC_HFSC_STAGE1_CTRL_ADDR A:0x60400840
y.create.l HWIO_BIMC_HFSC_STAGE2_CTRL_ADDR A:0x60400860
y.create.l HWIO_BIMC_BRIC_GLOBAL1_COMPONENT_INFO_ADDR A:0x60401000
y.create.l HWIO_BIMC_BRIC_HW_INFO_ADDR A:0x60401010
y.create.l HWIO_BIMC_BRIC_HW_VERSION_ADDR A:0x60401014
y.create.l HWIO_BIMC_BRIC_CONFIGURATION_INFO_0_ADDR A:0x60401020
y.create.l HWIO_BIMC_BRIC_CONFIGURATION_INFO_1_ADDR A:0x60401030
y.create.l HWIO_BIMC_BRIC_CONFIGURATION_INFO_2A_ADDR A:0x60401040
y.create.l HWIO_BIMC_BRIC_CONFIGURATION_INFO_2B_ADDR A:0x60401044
y.create.l HWIO_BIMC_BRIC_CONFIGURATION_INFO_2C_ADDR A:0x60401048
y.create.l HWIO_BIMC_BRIC_CONFIGURATION_INFO_2D_ADDR A:0x6040104c
y.create.l HWIO_BIMC_BRIC_INTERRUPT_0_STATUS_0_ADDR A:0x60401100
y.create.l HWIO_BIMC_BRIC_INTERRUPT_0_CLEAR_0_ADDR A:0x60401108
y.create.l HWIO_BIMC_BRIC_INTERRUPT_0_ENABLE_0_ADDR A:0x6040110c
y.create.l HWIO_BIMC_BRIC_INTERRUPT_0_STATUS_1_ADDR A:0x60401110
y.create.l HWIO_BIMC_BRIC_INTERRUPT_0_CLEAR_1_ADDR A:0x60401118
y.create.l HWIO_BIMC_BRIC_INTERRUPT_0_ENABLE_1_ADDR A:0x6040111c
y.create.l HWIO_BIMC_BRIC_INTERRUPT_0_STATUS_2_ADDR A:0x60401120
y.create.l HWIO_BIMC_BRIC_INTERRUPT_0_CLEAR_2_ADDR A:0x60401128
y.create.l HWIO_BIMC_BRIC_INTERRUPT_0_ENABLE_2_ADDR A:0x6040112c
y.create.l HWIO_BIMC_BRIC_INTERRUPT_0_STATUS_3_ADDR A:0x60401130
y.create.l HWIO_BIMC_BRIC_INTERRUPT_0_CLEAR_3_ADDR A:0x60401138
y.create.l HWIO_BIMC_BRIC_INTERRUPT_0_ENABLE_3_ADDR A:0x6040113c
y.create.l HWIO_BIMC_BRIC_INTERRUPT_0_STATUS_4_ADDR A:0x60401140
y.create.l HWIO_BIMC_BRIC_INTERRUPT_0_CLEAR_4_ADDR A:0x60401148
y.create.l HWIO_BIMC_BRIC_INTERRUPT_0_ENABLE_4_ADDR A:0x6040114c
y.create.l HWIO_BIMC_BRIC_INTERRUPT_2_STATUS_0_ADDR A:0x60401180
y.create.l HWIO_BIMC_BRIC_INTERRUPT_2_CLEAR_0_ADDR A:0x60401188
y.create.l HWIO_BIMC_BRIC_INTERRUPT_2_ENABLE_0_ADDR A:0x6040118c
y.create.l HWIO_BIMC_BRIC_INTERRUPT_2_STATUS_1_ADDR A:0x60401190
y.create.l HWIO_BIMC_BRIC_INTERRUPT_2_CLEAR_1_ADDR A:0x60401198
y.create.l HWIO_BIMC_BRIC_INTERRUPT_2_ENABLE_1_ADDR A:0x6040119c
y.create.l HWIO_BIMC_BRIC_INTERRUPT_2_STATUS_2_ADDR A:0x604011a0
y.create.l HWIO_BIMC_BRIC_INTERRUPT_2_CLEAR_2_ADDR A:0x604011a8
y.create.l HWIO_BIMC_BRIC_INTERRUPT_2_ENABLE_2_ADDR A:0x604011ac
y.create.l HWIO_BIMC_BRIC_INTERRUPT_2_STATUS_3_ADDR A:0x604011b0
y.create.l HWIO_BIMC_BRIC_INTERRUPT_2_CLEAR_3_ADDR A:0x604011b8
y.create.l HWIO_BIMC_BRIC_INTERRUPT_2_ENABLE_3_ADDR A:0x604011bc
y.create.l HWIO_BIMC_BRIC_INTERRUPT_2_STATUS_4_ADDR A:0x604011c0
y.create.l HWIO_BIMC_BRIC_INTERRUPT_2_CLEAR_4_ADDR A:0x604011c8
y.create.l HWIO_BIMC_BRIC_INTERRUPT_2_ENABLE_4_ADDR A:0x604011cc
y.create.l HWIO_BIMC_BRIC_REF_TIMER_INTERVAL_ADDR A:0x60401200
y.create.l HWIO_BIMC_BRIC_DEBUG_SELECT_ADDR A:0x60401210
y.create.l HWIO_BIMC_BRIC_MSA_LOCKS_ADDR A:0x60401300
y.create.l HWIO_BIMC_BRIC_PROTNS_LOCKS_ADDR A:0x60401310
y.create.l HWIO_BIMC_BRIC_GLOBAL2_COMPONENT_INFO_ADDR A:0x60402000
y.create.l HWIO_BIMC_BRIC_INTERRUPT_1_STATUS_0_ADDR A:0x60402100
y.create.l HWIO_BIMC_BRIC_INTERRUPT_1_CLEAR_0_ADDR A:0x60402108
y.create.l HWIO_BIMC_BRIC_INTERRUPT_1_ENABLE_0_ADDR A:0x6040210c
y.create.l HWIO_BIMC_BRIC_INTERRUPT_1_STATUS_1_ADDR A:0x60402110
y.create.l HWIO_BIMC_BRIC_INTERRUPT_1_CLEAR_1_ADDR A:0x60402118
y.create.l HWIO_BIMC_BRIC_INTERRUPT_1_ENABLE_1_ADDR A:0x6040211c
y.create.l HWIO_BIMC_BRIC_INTERRUPT_1_STATUS_2_ADDR A:0x60402120
y.create.l HWIO_BIMC_BRIC_INTERRUPT_1_CLEAR_2_ADDR A:0x60402128
y.create.l HWIO_BIMC_BRIC_INTERRUPT_1_ENABLE_2_ADDR A:0x6040212c
y.create.l HWIO_BIMC_BRIC_INTERRUPT_1_STATUS_3_ADDR A:0x60402130
y.create.l HWIO_BIMC_BRIC_INTERRUPT_1_CLEAR_3_ADDR A:0x60402138
y.create.l HWIO_BIMC_BRIC_INTERRUPT_1_ENABLE_3_ADDR A:0x6040213c
y.create.l HWIO_BIMC_BRIC_INTERRUPT_1_STATUS_4_ADDR A:0x60402140
y.create.l HWIO_BIMC_BRIC_INTERRUPT_1_CLEAR_4_ADDR A:0x60402148
y.create.l HWIO_BIMC_BRIC_INTERRUPT_1_ENABLE_4_ADDR A:0x6040214c
y.create.l HWIO_BIMC_BRIC_DEFAULT_SEGMENT_ADDR A:0x604021f0
y.create.l HWIO_BIMC_BRIC_SEGMENT0_ADDR_BASE_A_LOWER_ADDR A:0x60402200
y.create.l HWIO_BIMC_BRIC_SEGMENT1_ADDR_BASE_A_LOWER_ADDR A:0x60402280
y.create.l HWIO_BIMC_BRIC_SEGMENT2_ADDR_BASE_A_LOWER_ADDR A:0x60402300
y.create.l HWIO_BIMC_BRIC_SEGMENT0_ADDR_BASE_A_UPPER_ADDR A:0x60402204
y.create.l HWIO_BIMC_BRIC_SEGMENT1_ADDR_BASE_A_UPPER_ADDR A:0x60402284
y.create.l HWIO_BIMC_BRIC_SEGMENT2_ADDR_BASE_A_UPPER_ADDR A:0x60402304
y.create.l HWIO_BIMC_BRIC_SEGMENT0_ADDR_MASK_A_LOWER_ADDR A:0x60402208
y.create.l HWIO_BIMC_BRIC_SEGMENT1_ADDR_MASK_A_LOWER_ADDR A:0x60402288
y.create.l HWIO_BIMC_BRIC_SEGMENT2_ADDR_MASK_A_LOWER_ADDR A:0x60402308
y.create.l HWIO_BIMC_BRIC_SEGMENT0_ADDR_MASK_A_UPPER_ADDR A:0x6040220c
y.create.l HWIO_BIMC_BRIC_SEGMENT1_ADDR_MASK_A_UPPER_ADDR A:0x6040228c
y.create.l HWIO_BIMC_BRIC_SEGMENT2_ADDR_MASK_A_UPPER_ADDR A:0x6040230c
y.create.l HWIO_BIMC_BRIC_SEGMENT0_ADDR_BASE_B_LOWER_ADDR A:0x60402210
y.create.l HWIO_BIMC_BRIC_SEGMENT1_ADDR_BASE_B_LOWER_ADDR A:0x60402290
y.create.l HWIO_BIMC_BRIC_SEGMENT2_ADDR_BASE_B_LOWER_ADDR A:0x60402310
y.create.l HWIO_BIMC_BRIC_SEGMENT0_ADDR_BASE_B_UPPER_ADDR A:0x60402214
y.create.l HWIO_BIMC_BRIC_SEGMENT1_ADDR_BASE_B_UPPER_ADDR A:0x60402294
y.create.l HWIO_BIMC_BRIC_SEGMENT2_ADDR_BASE_B_UPPER_ADDR A:0x60402314
y.create.l HWIO_BIMC_BRIC_SEGMENT0_ADDR_MASK_B_LOWER_ADDR A:0x60402218
y.create.l HWIO_BIMC_BRIC_SEGMENT1_ADDR_MASK_B_LOWER_ADDR A:0x60402298
y.create.l HWIO_BIMC_BRIC_SEGMENT2_ADDR_MASK_B_LOWER_ADDR A:0x60402318
y.create.l HWIO_BIMC_BRIC_SEGMENT0_ADDR_MASK_B_UPPER_ADDR A:0x6040221c
y.create.l HWIO_BIMC_BRIC_SEGMENT1_ADDR_MASK_B_UPPER_ADDR A:0x6040229c
y.create.l HWIO_BIMC_BRIC_SEGMENT2_ADDR_MASK_B_UPPER_ADDR A:0x6040231c
y.create.l HWIO_BIMC_BRIC_SEGMENT0_ADDR_BASE_C_LOWER_ADDR A:0x60402220
y.create.l HWIO_BIMC_BRIC_SEGMENT1_ADDR_BASE_C_LOWER_ADDR A:0x604022a0
y.create.l HWIO_BIMC_BRIC_SEGMENT2_ADDR_BASE_C_LOWER_ADDR A:0x60402320
y.create.l HWIO_BIMC_BRIC_SEGMENT0_ADDR_BASE_C_UPPER_ADDR A:0x60402224
y.create.l HWIO_BIMC_BRIC_SEGMENT1_ADDR_BASE_C_UPPER_ADDR A:0x604022a4
y.create.l HWIO_BIMC_BRIC_SEGMENT2_ADDR_BASE_C_UPPER_ADDR A:0x60402324
y.create.l HWIO_BIMC_BRIC_SEGMENT0_ADDR_MASK_C_LOWER_ADDR A:0x60402228
y.create.l HWIO_BIMC_BRIC_SEGMENT1_ADDR_MASK_C_LOWER_ADDR A:0x604022a8
y.create.l HWIO_BIMC_BRIC_SEGMENT2_ADDR_MASK_C_LOWER_ADDR A:0x60402328
y.create.l HWIO_BIMC_BRIC_SEGMENT0_ADDR_MASK_C_UPPER_ADDR A:0x6040222c
y.create.l HWIO_BIMC_BRIC_SEGMENT1_ADDR_MASK_C_UPPER_ADDR A:0x604022ac
y.create.l HWIO_BIMC_BRIC_SEGMENT2_ADDR_MASK_C_UPPER_ADDR A:0x6040232c
y.create.l HWIO_BIMC_BRIC_REMAP0_ADDR_BASE_LOWER_ADDR A:0x60402a00
y.create.l HWIO_BIMC_BRIC_REMAP1_ADDR_BASE_LOWER_ADDR A:0x60402a40
y.create.l HWIO_BIMC_BRIC_REMAP2_ADDR_BASE_LOWER_ADDR A:0x60402a80
y.create.l HWIO_BIMC_BRIC_REMAP3_ADDR_BASE_LOWER_ADDR A:0x60402ac0
y.create.l HWIO_BIMC_BRIC_REMAP0_ADDR_BASE_UPPER_ADDR A:0x60402a04
y.create.l HWIO_BIMC_BRIC_REMAP1_ADDR_BASE_UPPER_ADDR A:0x60402a44
y.create.l HWIO_BIMC_BRIC_REMAP2_ADDR_BASE_UPPER_ADDR A:0x60402a84
y.create.l HWIO_BIMC_BRIC_REMAP3_ADDR_BASE_UPPER_ADDR A:0x60402ac4
y.create.l HWIO_BIMC_BRIC_REMAP0_ADDR_MASK_LOWER_ADDR A:0x60402a08
y.create.l HWIO_BIMC_BRIC_REMAP1_ADDR_MASK_LOWER_ADDR A:0x60402a48
y.create.l HWIO_BIMC_BRIC_REMAP2_ADDR_MASK_LOWER_ADDR A:0x60402a88
y.create.l HWIO_BIMC_BRIC_REMAP3_ADDR_MASK_LOWER_ADDR A:0x60402ac8
y.create.l HWIO_BIMC_BRIC_REMAP0_ADDR_MASK_UPPER_ADDR A:0x60402a0c
y.create.l HWIO_BIMC_BRIC_REMAP1_ADDR_MASK_UPPER_ADDR A:0x60402a4c
y.create.l HWIO_BIMC_BRIC_REMAP2_ADDR_MASK_UPPER_ADDR A:0x60402a8c
y.create.l HWIO_BIMC_BRIC_REMAP3_ADDR_MASK_UPPER_ADDR A:0x60402acc
y.create.l HWIO_BIMC_BRIC_REMAP0_OP0_ADDR A:0x60402a20
y.create.l HWIO_BIMC_BRIC_REMAP1_OP0_ADDR A:0x60402a60
y.create.l HWIO_BIMC_BRIC_REMAP2_OP0_ADDR A:0x60402aa0
y.create.l HWIO_BIMC_BRIC_REMAP3_OP0_ADDR A:0x60402ae0
y.create.l HWIO_BIMC_BRIC_REMAP0_OP1_ADDR A:0x60402a24
y.create.l HWIO_BIMC_BRIC_REMAP1_OP1_ADDR A:0x60402a64
y.create.l HWIO_BIMC_BRIC_REMAP2_OP1_ADDR A:0x60402aa4
y.create.l HWIO_BIMC_BRIC_REMAP3_OP1_ADDR A:0x60402ae4
y.create.l HWIO_BIMC_PERFMON_COMPONENT_INFO_ADDR A:0x60403000
y.create.l HWIO_BIMC_PERFMON_CONFIGURATION_INFO_ADDR A:0x60403020
y.create.l HWIO_BIMC_PERFMON_CLOCK_CTRL_ADDR A:0x60403200
y.create.l HWIO_BIMC_PERFMON_MODE_ADDR A:0x60403210
y.create.l HWIO_BIMC_PERFMON_DUMP_ADDR A:0x60403214
y.create.l HWIO_BIMC_PERFMON_TIMED_MODE_INTERVAL_ADDR A:0x60403220
y.create.l HWIO_BIMC_PERFMON_TIMED_MODE_ITERATIONS_ADDR A:0x60403230
y.create.l HWIO_BIMC_PERFMON_STATUS_ADDR A:0x604032f0
y.create.l HWIO_BIMC_PERFMON_COUNTER_0_CONFIG_ADDR A:0x60403300
y.create.l HWIO_BIMC_PERFMON_COUNTER_1_CONFIG_ADDR A:0x60403310
y.create.l HWIO_BIMC_PERFMON_COUNTER_2_CONFIG_ADDR A:0x60403320
y.create.l HWIO_BIMC_PERFMON_COUNTER_3_CONFIG_ADDR A:0x60403330
y.create.l HWIO_BIMC_PERFMON_COUNTER_4_CONFIG_ADDR A:0x60403340
y.create.l HWIO_BIMC_PERFMON_COUNTER_5_CONFIG_ADDR A:0x60403350
y.create.l HWIO_BIMC_PERFMON_COUNTER_6_CONFIG_ADDR A:0x60403360
y.create.l HWIO_BIMC_PERFMON_COUNTER_7_CONFIG_ADDR A:0x60403370
y.create.l HWIO_BIMC_PERFMON_COUNTER_8_CONFIG_ADDR A:0x60403380
y.create.l HWIO_BIMC_PERFMON_COUNTER_9_CONFIG_ADDR A:0x60403390
y.create.l HWIO_BIMC_PERFMON_COUNTER_0_ADDR A:0x60403308
y.create.l HWIO_BIMC_PERFMON_COUNTER_1_ADDR A:0x60403318
y.create.l HWIO_BIMC_PERFMON_COUNTER_2_ADDR A:0x60403328
y.create.l HWIO_BIMC_PERFMON_COUNTER_3_ADDR A:0x60403338
y.create.l HWIO_BIMC_PERFMON_COUNTER_4_ADDR A:0x60403348
y.create.l HWIO_BIMC_PERFMON_COUNTER_5_ADDR A:0x60403358
y.create.l HWIO_BIMC_PERFMON_COUNTER_6_ADDR A:0x60403368
y.create.l HWIO_BIMC_PERFMON_COUNTER_7_ADDR A:0x60403378
y.create.l HWIO_BIMC_PERFMON_COUNTER_8_ADDR A:0x60403388
y.create.l HWIO_BIMC_PERFMON_COUNTER_9_ADDR A:0x60403398
y.create.l HWIO_BIMC_PERFMON_COUNTER_0_OVERFLOW_ADDR A:0x6040330c
y.create.l HWIO_BIMC_PERFMON_COUNTER_1_OVERFLOW_ADDR A:0x6040331c
y.create.l HWIO_BIMC_PERFMON_COUNTER_2_OVERFLOW_ADDR A:0x6040332c
y.create.l HWIO_BIMC_PERFMON_COUNTER_3_OVERFLOW_ADDR A:0x6040333c
y.create.l HWIO_BIMC_PERFMON_COUNTER_4_OVERFLOW_ADDR A:0x6040334c
y.create.l HWIO_BIMC_PERFMON_COUNTER_5_OVERFLOW_ADDR A:0x6040335c
y.create.l HWIO_BIMC_PERFMON_COUNTER_6_OVERFLOW_ADDR A:0x6040336c
y.create.l HWIO_BIMC_PERFMON_COUNTER_7_OVERFLOW_ADDR A:0x6040337c
y.create.l HWIO_BIMC_PERFMON_COUNTER_8_OVERFLOW_ADDR A:0x6040338c
y.create.l HWIO_BIMC_PERFMON_COUNTER_9_OVERFLOW_ADDR A:0x6040339c
y.create.l HWIO_BIMC_DTE_HW_INFO_ADDR A:0x60406000
y.create.l HWIO_BIMC_DTE_GLOBAL_CNTL_ADDR A:0x60406004
y.create.l HWIO_BIMC_DTE_PROGRAM_CNTL_ADDR A:0x6040600c
y.create.l HWIO_BIMC_DTE_REG_CNTL_ADDR A:0x60406010
y.create.l HWIO_BIMC_DTE_REG_DATA_ADDR A:0x60406014
y.create.l HWIO_BIMC_DTE_TEST_STATUS_DDR_ADDR A:0x60406020
y.create.l HWIO_BIMC_DTE_TEST_STATUS_QSB_ADDR A:0x60406024
y.create.l HWIO_BIMC_DTE_TEST_MEM_CNTL_ADDR A:0x60406030
y.create.l HWIO_BIMC_DTE_TEST_MEM_DATA_0_ADDR A:0x60406038
y.create.l HWIO_BIMC_DTE_TEST_MEM_DATA_1_ADDR A:0x6040603c
y.create.l HWIO_BIMC_M_APP_MPORT_COMPONENT_INFO_ADDR A:0x60408000
y.create.l HWIO_BIMC_M_APP_MPORT_CONFIGURATION_INFO_0_ADDR A:0x60408020
y.create.l HWIO_BIMC_M_APP_MPORT_CONFIGURATION_INFO_1_ADDR A:0x60408030
y.create.l HWIO_BIMC_M_APP_MPORT_CONFIGURATION_INFO_2A_ADDR A:0x60408040
y.create.l HWIO_BIMC_M_APP_MPORT_CONFIGURATION_INFO_2B_ADDR A:0x60408044
y.create.l HWIO_BIMC_M_APP_MPORT_CONFIGURATION_INFO_3_ADDR A:0x60408050
y.create.l HWIO_BIMC_M_APP_MPORT_CONFIGURATION_INFO_4_ADDR A:0x60408060
y.create.l HWIO_BIMC_M_APP_MPORT_CONFIGURATION_INFO_5A_ADDR A:0x60408070
y.create.l HWIO_BIMC_M_APP_MPORT_CONFIGURATION_INFO_5B_ADDR A:0x60408074
y.create.l HWIO_BIMC_M_APP_MPORT_CONFIGURATION_INFO_5C_ADDR A:0x60408078
y.create.l HWIO_BIMC_M_APP_MPORT_CONFIGURATION_INFO_5D_ADDR A:0x6040807c
y.create.l HWIO_BIMC_M_APP_MPORT_INTERRUPT_STATUS_ADDR A:0x60408100
y.create.l HWIO_BIMC_M_APP_MPORT_INTERRUPT_CLEAR_ADDR A:0x60408108
y.create.l HWIO_BIMC_M_APP_MPORT_INTERRUPT_ENABLE_ADDR A:0x6040810c
y.create.l HWIO_BIMC_M_APP_MPORT_CLOCK_CTRL_ADDR A:0x60408200
y.create.l HWIO_BIMC_M_APP_MPORT_CDC_CTRL_ADDR A:0x60408208
y.create.l HWIO_BIMC_M_APP_MPORT_MODE_ADDR A:0x60408210
y.create.l HWIO_BIMC_M_APP_MPORT_WR_WAY_CROSSING_ADDR A:0x60408220
y.create.l HWIO_BIMC_M_APP_MPORT_PRIORITYLVL_OVERRIDE_ADDR A:0x60408230
y.create.l HWIO_BIMC_M_APP_MPORT_READ_COMMAND_OVERRIDE_ADDR A:0x60408240
y.create.l HWIO_BIMC_M_APP_MPORT_WRITE_COMMAND_OVERRIDE_ADDR A:0x60408250
y.create.l HWIO_BIMC_M_APP_MPORT_RD_TRACKING_INDEX_ADDR A:0x60408270
y.create.l HWIO_BIMC_M_APP_MPORT_WR_TRACKING_INDEX_ADDR A:0x60408274
y.create.l HWIO_BIMC_M_APP_MPORT_BWMON_ENABLE_ADDR A:0x60408280
y.create.l HWIO_BIMC_M_APP_MPORT_BWMON_CLEAR_ADDR A:0x60408284
y.create.l HWIO_BIMC_M_APP_MPORT_BWMON_BYTE_COUNT_ADDR A:0x60408288
y.create.l HWIO_BIMC_M_APP_MPORT_BWMON_THRESHOLD_ADDR A:0x60408290
y.create.l HWIO_BIMC_M_APP_MPORT_BWMON_MID_MASK_ADDR A:0x60408298
y.create.l HWIO_BIMC_M_APP_MPORT_BWMON_MID_MATCH_ADDR A:0x6040829c
y.create.l HWIO_BIMC_M_APP_MPORT_BKE_ENABLE_ADDR A:0x60408300
y.create.l HWIO_BIMC_M_APP_MPORT_BKE_GRANT_PERIOD_ADDR A:0x60408304
y.create.l HWIO_BIMC_M_APP_MPORT_BKE_GRANT_COUNT_ADDR A:0x60408308
y.create.l HWIO_BIMC_M_APP_MPORT_BKE_THRESHOLD_HIGH_ADDR A:0x60408320
y.create.l HWIO_BIMC_M_APP_MPORT_BKE_THRESHOLD_MEDIUM_ADDR A:0x60408324
y.create.l HWIO_BIMC_M_APP_MPORT_BKE_THRESHOLD_LOW_ADDR A:0x60408328
y.create.l HWIO_BIMC_M_APP_MPORT_BKE_HEALTH_0_ADDR A:0x60408340
y.create.l HWIO_BIMC_M_APP_MPORT_BKE_HEALTH_1_ADDR A:0x60408344
y.create.l HWIO_BIMC_M_APP_MPORT_BKE_HEALTH_2_ADDR A:0x60408348
y.create.l HWIO_BIMC_M_APP_MPORT_BKE_HEALTH_3_ADDR A:0x6040834c
y.create.l HWIO_BIMC_M_APP_MPORT_STATUS_2A_ADDR A:0x60408420
y.create.l HWIO_BIMC_M_APP_MPORT_STATUS_2B_ADDR A:0x60408424
y.create.l HWIO_BIMC_M_APP_MPORT_STATUS_3A_ADDR A:0x60408430
y.create.l HWIO_BIMC_M_APP_MPORT_STATUS_3B_ADDR A:0x60408434
y.create.l HWIO_BIMC_M_APP_MPORT_BKE1_ENABLE_ADDR A:0x60408800
y.create.l HWIO_BIMC_M_APP_MPORT_BKE1_GRANT_PERIOD_ADDR A:0x60408804
y.create.l HWIO_BIMC_M_APP_MPORT_BKE1_GRANT_COUNT_ADDR A:0x60408808
y.create.l HWIO_BIMC_M_APP_MPORT_BKE1_THRESHOLD_HIGH_ADDR A:0x60408820
y.create.l HWIO_BIMC_M_APP_MPORT_BKE1_THRESHOLD_MEDIUM_ADDR A:0x60408824
y.create.l HWIO_BIMC_M_APP_MPORT_BKE1_THRESHOLD_LOW_ADDR A:0x60408828
y.create.l HWIO_BIMC_M_APP_MPORT_BKE1_HEALTH_0_ADDR A:0x60408840
y.create.l HWIO_BIMC_M_APP_MPORT_BKE1_HEALTH_1_ADDR A:0x60408844
y.create.l HWIO_BIMC_M_APP_MPORT_BKE1_HEALTH_2_ADDR A:0x60408848
y.create.l HWIO_BIMC_M_APP_MPORT_BKE1_HEALTH_3_ADDR A:0x6040884c
y.create.l HWIO_BIMC_M_APP_MPORT_BKE2_ENABLE_ADDR A:0x60408900
y.create.l HWIO_BIMC_M_APP_MPORT_BKE2_GRANT_PERIOD_ADDR A:0x60408904
y.create.l HWIO_BIMC_M_APP_MPORT_BKE2_GRANT_COUNT_ADDR A:0x60408908
y.create.l HWIO_BIMC_M_APP_MPORT_BKE2_THRESHOLD_HIGH_ADDR A:0x60408920
y.create.l HWIO_BIMC_M_APP_MPORT_BKE2_THRESHOLD_MEDIUM_ADDR A:0x60408924
y.create.l HWIO_BIMC_M_APP_MPORT_BKE2_THRESHOLD_LOW_ADDR A:0x60408928
y.create.l HWIO_BIMC_M_APP_MPORT_BKE2_HEALTH_0_ADDR A:0x60408940
y.create.l HWIO_BIMC_M_APP_MPORT_BKE2_HEALTH_1_ADDR A:0x60408944
y.create.l HWIO_BIMC_M_APP_MPORT_BKE2_HEALTH_2_ADDR A:0x60408948
y.create.l HWIO_BIMC_M_APP_MPORT_BKE2_HEALTH_3_ADDR A:0x6040894c
y.create.l HWIO_BIMC_M_APP_MPORT_BKE3_ENABLE_ADDR A:0x60408a00
y.create.l HWIO_BIMC_M_APP_MPORT_BKE3_GRANT_PERIOD_ADDR A:0x60408a04
y.create.l HWIO_BIMC_M_APP_MPORT_BKE3_GRANT_COUNT_ADDR A:0x60408a08
y.create.l HWIO_BIMC_M_APP_MPORT_BKE3_THRESHOLD_HIGH_ADDR A:0x60408a20
y.create.l HWIO_BIMC_M_APP_MPORT_BKE3_THRESHOLD_MEDIUM_ADDR A:0x60408a24
y.create.l HWIO_BIMC_M_APP_MPORT_BKE3_THRESHOLD_LOW_ADDR A:0x60408a28
y.create.l HWIO_BIMC_M_APP_MPORT_BKE3_HEALTH_0_ADDR A:0x60408a40
y.create.l HWIO_BIMC_M_APP_MPORT_BKE3_HEALTH_1_ADDR A:0x60408a44
y.create.l HWIO_BIMC_M_APP_MPORT_BKE3_HEALTH_2_ADDR A:0x60408a48
y.create.l HWIO_BIMC_M_APP_MPORT_BKE3_HEALTH_3_ADDR A:0x60408a4c
y.create.l HWIO_BIMC_M_APP_PROF_COMPONENT_INFO_ADDR A:0x60409000
y.create.l HWIO_BIMC_M_APP_PROF_CONFIGURATION_INFO_0_ADDR A:0x60409020
y.create.l HWIO_BIMC_M_APP_PROF_CONFIGURATION_INFO_1_ADDR A:0x60409030
y.create.l HWIO_BIMC_M_APP_PROF_CLOCK_CTRL_ADDR A:0x60409200
y.create.l HWIO_BIMC_M_APP_PROF_MODE_ADDR A:0x60409210
y.create.l HWIO_BIMC_M_APP_PROF_RD_TENURE_THRESHOLD_ADDR A:0x60409214
y.create.l HWIO_BIMC_M_APP_PROF_WR_TENURE_THRESHOLD_ADDR A:0x60409218
y.create.l HWIO_BIMC_M_APP_PROF_SWAY_SELECT_ADDR A:0x60409220
y.create.l HWIO_BIMC_M_APP_PROF_MID_MASK_ADDR A:0x60409230
y.create.l HWIO_BIMC_M_APP_PROF_MID_MATCH_ADDR A:0x60409234
y.create.l HWIO_BIMC_M_APP_PROF_MID_INV_MATCH_ADDR A:0x60409238
y.create.l HWIO_BIMC_M_APP_PROF_ADDR_MASK_LOWER_ADDR A:0x60409240
y.create.l HWIO_BIMC_M_APP_PROF_ADDR_MASK_UPPER_ADDR A:0x60409244
y.create.l HWIO_BIMC_M_APP_PROF_ADDR_MATCH_LOWER_ADDR A:0x60409248
y.create.l HWIO_BIMC_M_APP_PROF_ADDR_MATCH_UPPER_ADDR A:0x6040924c
y.create.l HWIO_BIMC_M_APP_PROF_ADDR_INV_MATCH_ADDR A:0x60409250
y.create.l HWIO_BIMC_M_APP_PROF_ACH_MASK_0_ADDR A:0x60409260
y.create.l HWIO_BIMC_M_APP_PROF_ACH_MATCH_0_ADDR A:0x60409264
y.create.l HWIO_BIMC_M_APP_PROF_ACH_MASK_1_ADDR A:0x60409270
y.create.l HWIO_BIMC_M_APP_PROF_ACH_MATCH_1_ADDR A:0x60409274
y.create.l HWIO_BIMC_M_APP_PROF_ACH_INV_MATCH_1_ADDR A:0x60409278
y.create.l HWIO_BIMC_M_APP_PROF_ACH_MASK_2_ADDR A:0x60409280
y.create.l HWIO_BIMC_M_APP_PROF_ACH_MATCH_2_ADDR A:0x60409284
y.create.l HWIO_BIMC_M_APP_PROF_ACH_MASK_3_ADDR A:0x60409290
y.create.l HWIO_BIMC_M_APP_PROF_ACH_MATCH_3_ADDR A:0x60409294
y.create.l HWIO_BIMC_M_APP_PROF_ACH_INV_MATCH_3_ADDR A:0x60409298
y.create.l HWIO_BIMC_M_APP_PROF_ACH_MASK_4_ADDR A:0x604092a0
y.create.l HWIO_BIMC_M_APP_PROF_ACH_MATCH_4_ADDR A:0x604092a4
y.create.l HWIO_BIMC_M_APP_PROF_ACH_INV_MATCH_4_ADDR A:0x604092a8
y.create.l HWIO_BIMC_M_APP_PROF_BCH_MASK_ADDR A:0x60409300
y.create.l HWIO_BIMC_M_APP_PROF_BCH_MATCH_ADDR A:0x60409304
y.create.l HWIO_BIMC_M_APP_PROF_BCH_INV_MATCH_ADDR A:0x60409308
y.create.l HWIO_BIMC_M_APP_PROF_RCH_MASK_ADDR A:0x60409340
y.create.l HWIO_BIMC_M_APP_PROF_RCH_MATCH_ADDR A:0x60409344
y.create.l HWIO_BIMC_M_APP_PROF_RCH_INV_MATCH_ADDR A:0x60409348
y.create.l HWIO_BIMC_M_APP_PROF_RD_STATUS_0_ADDR A:0x60409400
y.create.l HWIO_BIMC_M_APP_PROF_WR_STATUS_0_ADDR A:0x60409410
y.create.l HWIO_BIMC_M_DSP_MPORT_COMPONENT_INFO_ADDR A:0x6040c000
y.create.l HWIO_BIMC_M_DSP_MPORT_CONFIGURATION_INFO_0_ADDR A:0x6040c020
y.create.l HWIO_BIMC_M_DSP_MPORT_CONFIGURATION_INFO_1_ADDR A:0x6040c030
y.create.l HWIO_BIMC_M_DSP_MPORT_CONFIGURATION_INFO_2A_ADDR A:0x6040c040
y.create.l HWIO_BIMC_M_DSP_MPORT_CONFIGURATION_INFO_2B_ADDR A:0x6040c044
y.create.l HWIO_BIMC_M_DSP_MPORT_CONFIGURATION_INFO_3_ADDR A:0x6040c050
y.create.l HWIO_BIMC_M_DSP_MPORT_CONFIGURATION_INFO_4_ADDR A:0x6040c060
y.create.l HWIO_BIMC_M_DSP_MPORT_CONFIGURATION_INFO_5A_ADDR A:0x6040c070
y.create.l HWIO_BIMC_M_DSP_MPORT_CONFIGURATION_INFO_5B_ADDR A:0x6040c074
y.create.l HWIO_BIMC_M_DSP_MPORT_CONFIGURATION_INFO_5C_ADDR A:0x6040c078
y.create.l HWIO_BIMC_M_DSP_MPORT_CONFIGURATION_INFO_5D_ADDR A:0x6040c07c
y.create.l HWIO_BIMC_M_DSP_MPORT_INTERRUPT_STATUS_ADDR A:0x6040c100
y.create.l HWIO_BIMC_M_DSP_MPORT_INTERRUPT_CLEAR_ADDR A:0x6040c108
y.create.l HWIO_BIMC_M_DSP_MPORT_INTERRUPT_ENABLE_ADDR A:0x6040c10c
y.create.l HWIO_BIMC_M_DSP_MPORT_CLOCK_CTRL_ADDR A:0x6040c200
y.create.l HWIO_BIMC_M_DSP_MPORT_CDC_CTRL_ADDR A:0x6040c208
y.create.l HWIO_BIMC_M_DSP_MPORT_MODE_ADDR A:0x6040c210
y.create.l HWIO_BIMC_M_DSP_MPORT_WR_WAY_CROSSING_ADDR A:0x6040c220
y.create.l HWIO_BIMC_M_DSP_MPORT_PRIORITYLVL_OVERRIDE_ADDR A:0x6040c230
y.create.l HWIO_BIMC_M_DSP_MPORT_READ_COMMAND_OVERRIDE_ADDR A:0x6040c240
y.create.l HWIO_BIMC_M_DSP_MPORT_WRITE_COMMAND_OVERRIDE_ADDR A:0x6040c250
y.create.l HWIO_BIMC_M_DSP_MPORT_RD_TRACKING_INDEX_ADDR A:0x6040c270
y.create.l HWIO_BIMC_M_DSP_MPORT_WR_TRACKING_INDEX_ADDR A:0x6040c274
y.create.l HWIO_BIMC_M_DSP_MPORT_BWMON_ENABLE_ADDR A:0x6040c280
y.create.l HWIO_BIMC_M_DSP_MPORT_BWMON_CLEAR_ADDR A:0x6040c284
y.create.l HWIO_BIMC_M_DSP_MPORT_BWMON_BYTE_COUNT_ADDR A:0x6040c288
y.create.l HWIO_BIMC_M_DSP_MPORT_BWMON_THRESHOLD_ADDR A:0x6040c290
y.create.l HWIO_BIMC_M_DSP_MPORT_BWMON_MID_MASK_ADDR A:0x6040c298
y.create.l HWIO_BIMC_M_DSP_MPORT_BWMON_MID_MATCH_ADDR A:0x6040c29c
y.create.l HWIO_BIMC_M_DSP_MPORT_BKE_ENABLE_ADDR A:0x6040c300
y.create.l HWIO_BIMC_M_DSP_MPORT_BKE_GRANT_PERIOD_ADDR A:0x6040c304
y.create.l HWIO_BIMC_M_DSP_MPORT_BKE_GRANT_COUNT_ADDR A:0x6040c308
y.create.l HWIO_BIMC_M_DSP_MPORT_BKE_THRESHOLD_HIGH_ADDR A:0x6040c320
y.create.l HWIO_BIMC_M_DSP_MPORT_BKE_THRESHOLD_MEDIUM_ADDR A:0x6040c324
y.create.l HWIO_BIMC_M_DSP_MPORT_BKE_THRESHOLD_LOW_ADDR A:0x6040c328
y.create.l HWIO_BIMC_M_DSP_MPORT_BKE_HEALTH_0_ADDR A:0x6040c340
y.create.l HWIO_BIMC_M_DSP_MPORT_BKE_HEALTH_1_ADDR A:0x6040c344
y.create.l HWIO_BIMC_M_DSP_MPORT_BKE_HEALTH_2_ADDR A:0x6040c348
y.create.l HWIO_BIMC_M_DSP_MPORT_BKE_HEALTH_3_ADDR A:0x6040c34c
y.create.l HWIO_BIMC_M_DSP_MPORT_STATUS_2A_ADDR A:0x6040c420
y.create.l HWIO_BIMC_M_DSP_MPORT_STATUS_2B_ADDR A:0x6040c424
y.create.l HWIO_BIMC_M_DSP_MPORT_STATUS_3A_ADDR A:0x6040c430
y.create.l HWIO_BIMC_M_DSP_MPORT_STATUS_3B_ADDR A:0x6040c434
y.create.l HWIO_BIMC_M_DSP_MPORT_BKE1_ENABLE_ADDR A:0x6040c800
y.create.l HWIO_BIMC_M_DSP_MPORT_BKE1_GRANT_PERIOD_ADDR A:0x6040c804
y.create.l HWIO_BIMC_M_DSP_MPORT_BKE1_GRANT_COUNT_ADDR A:0x6040c808
y.create.l HWIO_BIMC_M_DSP_MPORT_BKE1_THRESHOLD_HIGH_ADDR A:0x6040c820
y.create.l HWIO_BIMC_M_DSP_MPORT_BKE1_THRESHOLD_MEDIUM_ADDR A:0x6040c824
y.create.l HWIO_BIMC_M_DSP_MPORT_BKE1_THRESHOLD_LOW_ADDR A:0x6040c828
y.create.l HWIO_BIMC_M_DSP_MPORT_BKE1_HEALTH_0_ADDR A:0x6040c840
y.create.l HWIO_BIMC_M_DSP_MPORT_BKE1_HEALTH_1_ADDR A:0x6040c844
y.create.l HWIO_BIMC_M_DSP_MPORT_BKE1_HEALTH_2_ADDR A:0x6040c848
y.create.l HWIO_BIMC_M_DSP_MPORT_BKE1_HEALTH_3_ADDR A:0x6040c84c
y.create.l HWIO_BIMC_M_DSP_MPORT_BKE2_ENABLE_ADDR A:0x6040c900
y.create.l HWIO_BIMC_M_DSP_MPORT_BKE2_GRANT_PERIOD_ADDR A:0x6040c904
y.create.l HWIO_BIMC_M_DSP_MPORT_BKE2_GRANT_COUNT_ADDR A:0x6040c908
y.create.l HWIO_BIMC_M_DSP_MPORT_BKE2_THRESHOLD_HIGH_ADDR A:0x6040c920
y.create.l HWIO_BIMC_M_DSP_MPORT_BKE2_THRESHOLD_MEDIUM_ADDR A:0x6040c924
y.create.l HWIO_BIMC_M_DSP_MPORT_BKE2_THRESHOLD_LOW_ADDR A:0x6040c928
y.create.l HWIO_BIMC_M_DSP_MPORT_BKE2_HEALTH_0_ADDR A:0x6040c940
y.create.l HWIO_BIMC_M_DSP_MPORT_BKE2_HEALTH_1_ADDR A:0x6040c944
y.create.l HWIO_BIMC_M_DSP_MPORT_BKE2_HEALTH_2_ADDR A:0x6040c948
y.create.l HWIO_BIMC_M_DSP_MPORT_BKE2_HEALTH_3_ADDR A:0x6040c94c
y.create.l HWIO_BIMC_M_DSP_MPORT_BKE3_ENABLE_ADDR A:0x6040ca00
y.create.l HWIO_BIMC_M_DSP_MPORT_BKE3_GRANT_PERIOD_ADDR A:0x6040ca04
y.create.l HWIO_BIMC_M_DSP_MPORT_BKE3_GRANT_COUNT_ADDR A:0x6040ca08
y.create.l HWIO_BIMC_M_DSP_MPORT_BKE3_THRESHOLD_HIGH_ADDR A:0x6040ca20
y.create.l HWIO_BIMC_M_DSP_MPORT_BKE3_THRESHOLD_MEDIUM_ADDR A:0x6040ca24
y.create.l HWIO_BIMC_M_DSP_MPORT_BKE3_THRESHOLD_LOW_ADDR A:0x6040ca28
y.create.l HWIO_BIMC_M_DSP_MPORT_BKE3_HEALTH_0_ADDR A:0x6040ca40
y.create.l HWIO_BIMC_M_DSP_MPORT_BKE3_HEALTH_1_ADDR A:0x6040ca44
y.create.l HWIO_BIMC_M_DSP_MPORT_BKE3_HEALTH_2_ADDR A:0x6040ca48
y.create.l HWIO_BIMC_M_DSP_MPORT_BKE3_HEALTH_3_ADDR A:0x6040ca4c
y.create.l HWIO_BIMC_M_DSP_PROF_COMPONENT_INFO_ADDR A:0x6040d000
y.create.l HWIO_BIMC_M_DSP_PROF_CONFIGURATION_INFO_0_ADDR A:0x6040d020
y.create.l HWIO_BIMC_M_DSP_PROF_CONFIGURATION_INFO_1_ADDR A:0x6040d030
y.create.l HWIO_BIMC_M_DSP_PROF_CLOCK_CTRL_ADDR A:0x6040d200
y.create.l HWIO_BIMC_M_DSP_PROF_MODE_ADDR A:0x6040d210
y.create.l HWIO_BIMC_M_DSP_PROF_RD_TENURE_THRESHOLD_ADDR A:0x6040d214
y.create.l HWIO_BIMC_M_DSP_PROF_WR_TENURE_THRESHOLD_ADDR A:0x6040d218
y.create.l HWIO_BIMC_M_DSP_PROF_SWAY_SELECT_ADDR A:0x6040d220
y.create.l HWIO_BIMC_M_DSP_PROF_MID_MASK_ADDR A:0x6040d230
y.create.l HWIO_BIMC_M_DSP_PROF_MID_MATCH_ADDR A:0x6040d234
y.create.l HWIO_BIMC_M_DSP_PROF_MID_INV_MATCH_ADDR A:0x6040d238
y.create.l HWIO_BIMC_M_DSP_PROF_ADDR_MASK_LOWER_ADDR A:0x6040d240
y.create.l HWIO_BIMC_M_DSP_PROF_ADDR_MASK_UPPER_ADDR A:0x6040d244
y.create.l HWIO_BIMC_M_DSP_PROF_ADDR_MATCH_LOWER_ADDR A:0x6040d248
y.create.l HWIO_BIMC_M_DSP_PROF_ADDR_MATCH_UPPER_ADDR A:0x6040d24c
y.create.l HWIO_BIMC_M_DSP_PROF_ADDR_INV_MATCH_ADDR A:0x6040d250
y.create.l HWIO_BIMC_M_DSP_PROF_ACH_MASK_0_ADDR A:0x6040d260
y.create.l HWIO_BIMC_M_DSP_PROF_ACH_MATCH_0_ADDR A:0x6040d264
y.create.l HWIO_BIMC_M_DSP_PROF_ACH_MASK_1_ADDR A:0x6040d270
y.create.l HWIO_BIMC_M_DSP_PROF_ACH_MATCH_1_ADDR A:0x6040d274
y.create.l HWIO_BIMC_M_DSP_PROF_ACH_INV_MATCH_1_ADDR A:0x6040d278
y.create.l HWIO_BIMC_M_DSP_PROF_ACH_MASK_2_ADDR A:0x6040d280
y.create.l HWIO_BIMC_M_DSP_PROF_ACH_MATCH_2_ADDR A:0x6040d284
y.create.l HWIO_BIMC_M_DSP_PROF_ACH_MASK_3_ADDR A:0x6040d290
y.create.l HWIO_BIMC_M_DSP_PROF_ACH_MATCH_3_ADDR A:0x6040d294
y.create.l HWIO_BIMC_M_DSP_PROF_ACH_INV_MATCH_3_ADDR A:0x6040d298
y.create.l HWIO_BIMC_M_DSP_PROF_ACH_MASK_4_ADDR A:0x6040d2a0
y.create.l HWIO_BIMC_M_DSP_PROF_ACH_MATCH_4_ADDR A:0x6040d2a4
y.create.l HWIO_BIMC_M_DSP_PROF_ACH_INV_MATCH_4_ADDR A:0x6040d2a8
y.create.l HWIO_BIMC_M_DSP_PROF_BCH_MASK_ADDR A:0x6040d300
y.create.l HWIO_BIMC_M_DSP_PROF_BCH_MATCH_ADDR A:0x6040d304
y.create.l HWIO_BIMC_M_DSP_PROF_BCH_INV_MATCH_ADDR A:0x6040d308
y.create.l HWIO_BIMC_M_DSP_PROF_RCH_MASK_ADDR A:0x6040d340
y.create.l HWIO_BIMC_M_DSP_PROF_RCH_MATCH_ADDR A:0x6040d344
y.create.l HWIO_BIMC_M_DSP_PROF_RCH_INV_MATCH_ADDR A:0x6040d348
y.create.l HWIO_BIMC_M_DSP_PROF_RD_STATUS_0_ADDR A:0x6040d400
y.create.l HWIO_BIMC_M_DSP_PROF_WR_STATUS_0_ADDR A:0x6040d410
y.create.l HWIO_BIMC_M_MCDMA_MPORT_COMPONENT_INFO_ADDR A:0x60410000
y.create.l HWIO_BIMC_M_MCDMA_MPORT_CONFIGURATION_INFO_0_ADDR A:0x60410020
y.create.l HWIO_BIMC_M_MCDMA_MPORT_CONFIGURATION_INFO_1_ADDR A:0x60410030
y.create.l HWIO_BIMC_M_MCDMA_MPORT_CONFIGURATION_INFO_2A_ADDR A:0x60410040
y.create.l HWIO_BIMC_M_MCDMA_MPORT_CONFIGURATION_INFO_2B_ADDR A:0x60410044
y.create.l HWIO_BIMC_M_MCDMA_MPORT_CONFIGURATION_INFO_3_ADDR A:0x60410050
y.create.l HWIO_BIMC_M_MCDMA_MPORT_CONFIGURATION_INFO_4_ADDR A:0x60410060
y.create.l HWIO_BIMC_M_MCDMA_MPORT_CONFIGURATION_INFO_5A_ADDR A:0x60410070
y.create.l HWIO_BIMC_M_MCDMA_MPORT_CONFIGURATION_INFO_5B_ADDR A:0x60410074
y.create.l HWIO_BIMC_M_MCDMA_MPORT_CONFIGURATION_INFO_5C_ADDR A:0x60410078
y.create.l HWIO_BIMC_M_MCDMA_MPORT_CONFIGURATION_INFO_5D_ADDR A:0x6041007c
y.create.l HWIO_BIMC_M_MCDMA_MPORT_INTERRUPT_STATUS_ADDR A:0x60410100
y.create.l HWIO_BIMC_M_MCDMA_MPORT_INTERRUPT_CLEAR_ADDR A:0x60410108
y.create.l HWIO_BIMC_M_MCDMA_MPORT_INTERRUPT_ENABLE_ADDR A:0x6041010c
y.create.l HWIO_BIMC_M_MCDMA_MPORT_CLOCK_CTRL_ADDR A:0x60410200
y.create.l HWIO_BIMC_M_MCDMA_MPORT_CDC_CTRL_ADDR A:0x60410208
y.create.l HWIO_BIMC_M_MCDMA_MPORT_MODE_ADDR A:0x60410210
y.create.l HWIO_BIMC_M_MCDMA_MPORT_WR_WAY_CROSSING_ADDR A:0x60410220
y.create.l HWIO_BIMC_M_MCDMA_MPORT_PRIORITYLVL_OVERRIDE_ADDR A:0x60410230
y.create.l HWIO_BIMC_M_MCDMA_MPORT_READ_COMMAND_OVERRIDE_ADDR A:0x60410240
y.create.l HWIO_BIMC_M_MCDMA_MPORT_WRITE_COMMAND_OVERRIDE_ADDR A:0x60410250
y.create.l HWIO_BIMC_M_MCDMA_MPORT_RD_TRACKING_INDEX_ADDR A:0x60410270
y.create.l HWIO_BIMC_M_MCDMA_MPORT_WR_TRACKING_INDEX_ADDR A:0x60410274
y.create.l HWIO_BIMC_M_MCDMA_MPORT_BWMON_ENABLE_ADDR A:0x60410280
y.create.l HWIO_BIMC_M_MCDMA_MPORT_BWMON_CLEAR_ADDR A:0x60410284
y.create.l HWIO_BIMC_M_MCDMA_MPORT_BWMON_BYTE_COUNT_ADDR A:0x60410288
y.create.l HWIO_BIMC_M_MCDMA_MPORT_BWMON_THRESHOLD_ADDR A:0x60410290
y.create.l HWIO_BIMC_M_MCDMA_MPORT_BWMON_MID_MASK_ADDR A:0x60410298
y.create.l HWIO_BIMC_M_MCDMA_MPORT_BWMON_MID_MATCH_ADDR A:0x6041029c
y.create.l HWIO_BIMC_M_MCDMA_MPORT_BKE_ENABLE_ADDR A:0x60410300
y.create.l HWIO_BIMC_M_MCDMA_MPORT_BKE_GRANT_PERIOD_ADDR A:0x60410304
y.create.l HWIO_BIMC_M_MCDMA_MPORT_BKE_GRANT_COUNT_ADDR A:0x60410308
y.create.l HWIO_BIMC_M_MCDMA_MPORT_BKE_THRESHOLD_HIGH_ADDR A:0x60410320
y.create.l HWIO_BIMC_M_MCDMA_MPORT_BKE_THRESHOLD_MEDIUM_ADDR A:0x60410324
y.create.l HWIO_BIMC_M_MCDMA_MPORT_BKE_THRESHOLD_LOW_ADDR A:0x60410328
y.create.l HWIO_BIMC_M_MCDMA_MPORT_BKE_HEALTH_0_ADDR A:0x60410340
y.create.l HWIO_BIMC_M_MCDMA_MPORT_BKE_HEALTH_1_ADDR A:0x60410344
y.create.l HWIO_BIMC_M_MCDMA_MPORT_BKE_HEALTH_2_ADDR A:0x60410348
y.create.l HWIO_BIMC_M_MCDMA_MPORT_BKE_HEALTH_3_ADDR A:0x6041034c
y.create.l HWIO_BIMC_M_MCDMA_MPORT_STATUS_2A_ADDR A:0x60410420
y.create.l HWIO_BIMC_M_MCDMA_MPORT_STATUS_2B_ADDR A:0x60410424
y.create.l HWIO_BIMC_M_MCDMA_MPORT_STATUS_3A_ADDR A:0x60410430
y.create.l HWIO_BIMC_M_MCDMA_MPORT_STATUS_3B_ADDR A:0x60410434
y.create.l HWIO_BIMC_M_MCDMA_MPORT_BKE1_ENABLE_ADDR A:0x60410800
y.create.l HWIO_BIMC_M_MCDMA_MPORT_BKE1_GRANT_PERIOD_ADDR A:0x60410804
y.create.l HWIO_BIMC_M_MCDMA_MPORT_BKE1_GRANT_COUNT_ADDR A:0x60410808
y.create.l HWIO_BIMC_M_MCDMA_MPORT_BKE1_THRESHOLD_HIGH_ADDR A:0x60410820
y.create.l HWIO_BIMC_M_MCDMA_MPORT_BKE1_THRESHOLD_MEDIUM_ADDR A:0x60410824
y.create.l HWIO_BIMC_M_MCDMA_MPORT_BKE1_THRESHOLD_LOW_ADDR A:0x60410828
y.create.l HWIO_BIMC_M_MCDMA_MPORT_BKE1_HEALTH_0_ADDR A:0x60410840
y.create.l HWIO_BIMC_M_MCDMA_MPORT_BKE1_HEALTH_1_ADDR A:0x60410844
y.create.l HWIO_BIMC_M_MCDMA_MPORT_BKE1_HEALTH_2_ADDR A:0x60410848
y.create.l HWIO_BIMC_M_MCDMA_MPORT_BKE1_HEALTH_3_ADDR A:0x6041084c
y.create.l HWIO_BIMC_M_MCDMA_MPORT_BKE2_ENABLE_ADDR A:0x60410900
y.create.l HWIO_BIMC_M_MCDMA_MPORT_BKE2_GRANT_PERIOD_ADDR A:0x60410904
y.create.l HWIO_BIMC_M_MCDMA_MPORT_BKE2_GRANT_COUNT_ADDR A:0x60410908
y.create.l HWIO_BIMC_M_MCDMA_MPORT_BKE2_THRESHOLD_HIGH_ADDR A:0x60410920
y.create.l HWIO_BIMC_M_MCDMA_MPORT_BKE2_THRESHOLD_MEDIUM_ADDR A:0x60410924
y.create.l HWIO_BIMC_M_MCDMA_MPORT_BKE2_THRESHOLD_LOW_ADDR A:0x60410928
y.create.l HWIO_BIMC_M_MCDMA_MPORT_BKE2_HEALTH_0_ADDR A:0x60410940
y.create.l HWIO_BIMC_M_MCDMA_MPORT_BKE2_HEALTH_1_ADDR A:0x60410944
y.create.l HWIO_BIMC_M_MCDMA_MPORT_BKE2_HEALTH_2_ADDR A:0x60410948
y.create.l HWIO_BIMC_M_MCDMA_MPORT_BKE2_HEALTH_3_ADDR A:0x6041094c
y.create.l HWIO_BIMC_M_MCDMA_MPORT_BKE3_ENABLE_ADDR A:0x60410a00
y.create.l HWIO_BIMC_M_MCDMA_MPORT_BKE3_GRANT_PERIOD_ADDR A:0x60410a04
y.create.l HWIO_BIMC_M_MCDMA_MPORT_BKE3_GRANT_COUNT_ADDR A:0x60410a08
y.create.l HWIO_BIMC_M_MCDMA_MPORT_BKE3_THRESHOLD_HIGH_ADDR A:0x60410a20
y.create.l HWIO_BIMC_M_MCDMA_MPORT_BKE3_THRESHOLD_MEDIUM_ADDR A:0x60410a24
y.create.l HWIO_BIMC_M_MCDMA_MPORT_BKE3_THRESHOLD_LOW_ADDR A:0x60410a28
y.create.l HWIO_BIMC_M_MCDMA_MPORT_BKE3_HEALTH_0_ADDR A:0x60410a40
y.create.l HWIO_BIMC_M_MCDMA_MPORT_BKE3_HEALTH_1_ADDR A:0x60410a44
y.create.l HWIO_BIMC_M_MCDMA_MPORT_BKE3_HEALTH_2_ADDR A:0x60410a48
y.create.l HWIO_BIMC_M_MCDMA_MPORT_BKE3_HEALTH_3_ADDR A:0x60410a4c
y.create.l HWIO_BIMC_M_MCDMA_PROF_COMPONENT_INFO_ADDR A:0x60411000
y.create.l HWIO_BIMC_M_MCDMA_PROF_CONFIGURATION_INFO_0_ADDR A:0x60411020
y.create.l HWIO_BIMC_M_MCDMA_PROF_CONFIGURATION_INFO_1_ADDR A:0x60411030
y.create.l HWIO_BIMC_M_MCDMA_PROF_CLOCK_CTRL_ADDR A:0x60411200
y.create.l HWIO_BIMC_M_MCDMA_PROF_MODE_ADDR A:0x60411210
y.create.l HWIO_BIMC_M_MCDMA_PROF_RD_TENURE_THRESHOLD_ADDR A:0x60411214
y.create.l HWIO_BIMC_M_MCDMA_PROF_WR_TENURE_THRESHOLD_ADDR A:0x60411218
y.create.l HWIO_BIMC_M_MCDMA_PROF_SWAY_SELECT_ADDR A:0x60411220
y.create.l HWIO_BIMC_M_MCDMA_PROF_MID_MASK_ADDR A:0x60411230
y.create.l HWIO_BIMC_M_MCDMA_PROF_MID_MATCH_ADDR A:0x60411234
y.create.l HWIO_BIMC_M_MCDMA_PROF_MID_INV_MATCH_ADDR A:0x60411238
y.create.l HWIO_BIMC_M_MCDMA_PROF_ADDR_MASK_LOWER_ADDR A:0x60411240
y.create.l HWIO_BIMC_M_MCDMA_PROF_ADDR_MASK_UPPER_ADDR A:0x60411244
y.create.l HWIO_BIMC_M_MCDMA_PROF_ADDR_MATCH_LOWER_ADDR A:0x60411248
y.create.l HWIO_BIMC_M_MCDMA_PROF_ADDR_MATCH_UPPER_ADDR A:0x6041124c
y.create.l HWIO_BIMC_M_MCDMA_PROF_ADDR_INV_MATCH_ADDR A:0x60411250
y.create.l HWIO_BIMC_M_MCDMA_PROF_ACH_MASK_0_ADDR A:0x60411260
y.create.l HWIO_BIMC_M_MCDMA_PROF_ACH_MATCH_0_ADDR A:0x60411264
y.create.l HWIO_BIMC_M_MCDMA_PROF_ACH_MASK_1_ADDR A:0x60411270
y.create.l HWIO_BIMC_M_MCDMA_PROF_ACH_MATCH_1_ADDR A:0x60411274
y.create.l HWIO_BIMC_M_MCDMA_PROF_ACH_INV_MATCH_1_ADDR A:0x60411278
y.create.l HWIO_BIMC_M_MCDMA_PROF_ACH_MASK_2_ADDR A:0x60411280
y.create.l HWIO_BIMC_M_MCDMA_PROF_ACH_MATCH_2_ADDR A:0x60411284
y.create.l HWIO_BIMC_M_MCDMA_PROF_ACH_MASK_3_ADDR A:0x60411290
y.create.l HWIO_BIMC_M_MCDMA_PROF_ACH_MATCH_3_ADDR A:0x60411294
y.create.l HWIO_BIMC_M_MCDMA_PROF_ACH_INV_MATCH_3_ADDR A:0x60411298
y.create.l HWIO_BIMC_M_MCDMA_PROF_ACH_MASK_4_ADDR A:0x604112a0
y.create.l HWIO_BIMC_M_MCDMA_PROF_ACH_MATCH_4_ADDR A:0x604112a4
y.create.l HWIO_BIMC_M_MCDMA_PROF_ACH_INV_MATCH_4_ADDR A:0x604112a8
y.create.l HWIO_BIMC_M_MCDMA_PROF_BCH_MASK_ADDR A:0x60411300
y.create.l HWIO_BIMC_M_MCDMA_PROF_BCH_MATCH_ADDR A:0x60411304
y.create.l HWIO_BIMC_M_MCDMA_PROF_BCH_INV_MATCH_ADDR A:0x60411308
y.create.l HWIO_BIMC_M_MCDMA_PROF_RCH_MASK_ADDR A:0x60411340
y.create.l HWIO_BIMC_M_MCDMA_PROF_RCH_MATCH_ADDR A:0x60411344
y.create.l HWIO_BIMC_M_MCDMA_PROF_RCH_INV_MATCH_ADDR A:0x60411348
y.create.l HWIO_BIMC_M_MCDMA_PROF_RD_STATUS_0_ADDR A:0x60411400
y.create.l HWIO_BIMC_M_MCDMA_PROF_WR_STATUS_0_ADDR A:0x60411410
y.create.l HWIO_BIMC_M_NAV_MPORT_COMPONENT_INFO_ADDR A:0x60414000
y.create.l HWIO_BIMC_M_NAV_MPORT_CONFIGURATION_INFO_0_ADDR A:0x60414020
y.create.l HWIO_BIMC_M_NAV_MPORT_CONFIGURATION_INFO_1_ADDR A:0x60414030
y.create.l HWIO_BIMC_M_NAV_MPORT_CONFIGURATION_INFO_2A_ADDR A:0x60414040
y.create.l HWIO_BIMC_M_NAV_MPORT_CONFIGURATION_INFO_2B_ADDR A:0x60414044
y.create.l HWIO_BIMC_M_NAV_MPORT_CONFIGURATION_INFO_3_ADDR A:0x60414050
y.create.l HWIO_BIMC_M_NAV_MPORT_CONFIGURATION_INFO_4_ADDR A:0x60414060
y.create.l HWIO_BIMC_M_NAV_MPORT_CONFIGURATION_INFO_5A_ADDR A:0x60414070
y.create.l HWIO_BIMC_M_NAV_MPORT_CONFIGURATION_INFO_5B_ADDR A:0x60414074
y.create.l HWIO_BIMC_M_NAV_MPORT_CONFIGURATION_INFO_5C_ADDR A:0x60414078
y.create.l HWIO_BIMC_M_NAV_MPORT_CONFIGURATION_INFO_5D_ADDR A:0x6041407c
y.create.l HWIO_BIMC_M_NAV_MPORT_INTERRUPT_STATUS_ADDR A:0x60414100
y.create.l HWIO_BIMC_M_NAV_MPORT_INTERRUPT_CLEAR_ADDR A:0x60414108
y.create.l HWIO_BIMC_M_NAV_MPORT_INTERRUPT_ENABLE_ADDR A:0x6041410c
y.create.l HWIO_BIMC_M_NAV_MPORT_CLOCK_CTRL_ADDR A:0x60414200
y.create.l HWIO_BIMC_M_NAV_MPORT_CDC_CTRL_ADDR A:0x60414208
y.create.l HWIO_BIMC_M_NAV_MPORT_MODE_ADDR A:0x60414210
y.create.l HWIO_BIMC_M_NAV_MPORT_WR_WAY_CROSSING_ADDR A:0x60414220
y.create.l HWIO_BIMC_M_NAV_MPORT_PRIORITYLVL_OVERRIDE_ADDR A:0x60414230
y.create.l HWIO_BIMC_M_NAV_MPORT_READ_COMMAND_OVERRIDE_ADDR A:0x60414240
y.create.l HWIO_BIMC_M_NAV_MPORT_WRITE_COMMAND_OVERRIDE_ADDR A:0x60414250
y.create.l HWIO_BIMC_M_NAV_MPORT_RD_TRACKING_INDEX_ADDR A:0x60414270
y.create.l HWIO_BIMC_M_NAV_MPORT_WR_TRACKING_INDEX_ADDR A:0x60414274
y.create.l HWIO_BIMC_M_NAV_MPORT_BWMON_ENABLE_ADDR A:0x60414280
y.create.l HWIO_BIMC_M_NAV_MPORT_BWMON_CLEAR_ADDR A:0x60414284
y.create.l HWIO_BIMC_M_NAV_MPORT_BWMON_BYTE_COUNT_ADDR A:0x60414288
y.create.l HWIO_BIMC_M_NAV_MPORT_BWMON_THRESHOLD_ADDR A:0x60414290
y.create.l HWIO_BIMC_M_NAV_MPORT_BWMON_MID_MASK_ADDR A:0x60414298
y.create.l HWIO_BIMC_M_NAV_MPORT_BWMON_MID_MATCH_ADDR A:0x6041429c
y.create.l HWIO_BIMC_M_NAV_MPORT_BKE_ENABLE_ADDR A:0x60414300
y.create.l HWIO_BIMC_M_NAV_MPORT_BKE_GRANT_PERIOD_ADDR A:0x60414304
y.create.l HWIO_BIMC_M_NAV_MPORT_BKE_GRANT_COUNT_ADDR A:0x60414308
y.create.l HWIO_BIMC_M_NAV_MPORT_BKE_THRESHOLD_HIGH_ADDR A:0x60414320
y.create.l HWIO_BIMC_M_NAV_MPORT_BKE_THRESHOLD_MEDIUM_ADDR A:0x60414324
y.create.l HWIO_BIMC_M_NAV_MPORT_BKE_THRESHOLD_LOW_ADDR A:0x60414328
y.create.l HWIO_BIMC_M_NAV_MPORT_BKE_HEALTH_0_ADDR A:0x60414340
y.create.l HWIO_BIMC_M_NAV_MPORT_BKE_HEALTH_1_ADDR A:0x60414344
y.create.l HWIO_BIMC_M_NAV_MPORT_BKE_HEALTH_2_ADDR A:0x60414348
y.create.l HWIO_BIMC_M_NAV_MPORT_BKE_HEALTH_3_ADDR A:0x6041434c
y.create.l HWIO_BIMC_M_NAV_MPORT_STATUS_2A_ADDR A:0x60414420
y.create.l HWIO_BIMC_M_NAV_MPORT_STATUS_2B_ADDR A:0x60414424
y.create.l HWIO_BIMC_M_NAV_MPORT_STATUS_3A_ADDR A:0x60414430
y.create.l HWIO_BIMC_M_NAV_MPORT_STATUS_3B_ADDR A:0x60414434
y.create.l HWIO_BIMC_M_NAV_MPORT_BKE1_ENABLE_ADDR A:0x60414800
y.create.l HWIO_BIMC_M_NAV_MPORT_BKE1_GRANT_PERIOD_ADDR A:0x60414804
y.create.l HWIO_BIMC_M_NAV_MPORT_BKE1_GRANT_COUNT_ADDR A:0x60414808
y.create.l HWIO_BIMC_M_NAV_MPORT_BKE1_THRESHOLD_HIGH_ADDR A:0x60414820
y.create.l HWIO_BIMC_M_NAV_MPORT_BKE1_THRESHOLD_MEDIUM_ADDR A:0x60414824
y.create.l HWIO_BIMC_M_NAV_MPORT_BKE1_THRESHOLD_LOW_ADDR A:0x60414828
y.create.l HWIO_BIMC_M_NAV_MPORT_BKE1_HEALTH_0_ADDR A:0x60414840
y.create.l HWIO_BIMC_M_NAV_MPORT_BKE1_HEALTH_1_ADDR A:0x60414844
y.create.l HWIO_BIMC_M_NAV_MPORT_BKE1_HEALTH_2_ADDR A:0x60414848
y.create.l HWIO_BIMC_M_NAV_MPORT_BKE1_HEALTH_3_ADDR A:0x6041484c
y.create.l HWIO_BIMC_M_NAV_MPORT_BKE2_ENABLE_ADDR A:0x60414900
y.create.l HWIO_BIMC_M_NAV_MPORT_BKE2_GRANT_PERIOD_ADDR A:0x60414904
y.create.l HWIO_BIMC_M_NAV_MPORT_BKE2_GRANT_COUNT_ADDR A:0x60414908
y.create.l HWIO_BIMC_M_NAV_MPORT_BKE2_THRESHOLD_HIGH_ADDR A:0x60414920
y.create.l HWIO_BIMC_M_NAV_MPORT_BKE2_THRESHOLD_MEDIUM_ADDR A:0x60414924
y.create.l HWIO_BIMC_M_NAV_MPORT_BKE2_THRESHOLD_LOW_ADDR A:0x60414928
y.create.l HWIO_BIMC_M_NAV_MPORT_BKE2_HEALTH_0_ADDR A:0x60414940
y.create.l HWIO_BIMC_M_NAV_MPORT_BKE2_HEALTH_1_ADDR A:0x60414944
y.create.l HWIO_BIMC_M_NAV_MPORT_BKE2_HEALTH_2_ADDR A:0x60414948
y.create.l HWIO_BIMC_M_NAV_MPORT_BKE2_HEALTH_3_ADDR A:0x6041494c
y.create.l HWIO_BIMC_M_NAV_MPORT_BKE3_ENABLE_ADDR A:0x60414a00
y.create.l HWIO_BIMC_M_NAV_MPORT_BKE3_GRANT_PERIOD_ADDR A:0x60414a04
y.create.l HWIO_BIMC_M_NAV_MPORT_BKE3_GRANT_COUNT_ADDR A:0x60414a08
y.create.l HWIO_BIMC_M_NAV_MPORT_BKE3_THRESHOLD_HIGH_ADDR A:0x60414a20
y.create.l HWIO_BIMC_M_NAV_MPORT_BKE3_THRESHOLD_MEDIUM_ADDR A:0x60414a24
y.create.l HWIO_BIMC_M_NAV_MPORT_BKE3_THRESHOLD_LOW_ADDR A:0x60414a28
y.create.l HWIO_BIMC_M_NAV_MPORT_BKE3_HEALTH_0_ADDR A:0x60414a40
y.create.l HWIO_BIMC_M_NAV_MPORT_BKE3_HEALTH_1_ADDR A:0x60414a44
y.create.l HWIO_BIMC_M_NAV_MPORT_BKE3_HEALTH_2_ADDR A:0x60414a48
y.create.l HWIO_BIMC_M_NAV_MPORT_BKE3_HEALTH_3_ADDR A:0x60414a4c
y.create.l HWIO_BIMC_M_NAV_PROF_COMPONENT_INFO_ADDR A:0x60415000
y.create.l HWIO_BIMC_M_NAV_PROF_CONFIGURATION_INFO_0_ADDR A:0x60415020
y.create.l HWIO_BIMC_M_NAV_PROF_CONFIGURATION_INFO_1_ADDR A:0x60415030
y.create.l HWIO_BIMC_M_NAV_PROF_CLOCK_CTRL_ADDR A:0x60415200
y.create.l HWIO_BIMC_M_NAV_PROF_MODE_ADDR A:0x60415210
y.create.l HWIO_BIMC_M_NAV_PROF_RD_TENURE_THRESHOLD_ADDR A:0x60415214
y.create.l HWIO_BIMC_M_NAV_PROF_WR_TENURE_THRESHOLD_ADDR A:0x60415218
y.create.l HWIO_BIMC_M_NAV_PROF_SWAY_SELECT_ADDR A:0x60415220
y.create.l HWIO_BIMC_M_NAV_PROF_MID_MASK_ADDR A:0x60415230
y.create.l HWIO_BIMC_M_NAV_PROF_MID_MATCH_ADDR A:0x60415234
y.create.l HWIO_BIMC_M_NAV_PROF_MID_INV_MATCH_ADDR A:0x60415238
y.create.l HWIO_BIMC_M_NAV_PROF_ADDR_MASK_LOWER_ADDR A:0x60415240
y.create.l HWIO_BIMC_M_NAV_PROF_ADDR_MASK_UPPER_ADDR A:0x60415244
y.create.l HWIO_BIMC_M_NAV_PROF_ADDR_MATCH_LOWER_ADDR A:0x60415248
y.create.l HWIO_BIMC_M_NAV_PROF_ADDR_MATCH_UPPER_ADDR A:0x6041524c
y.create.l HWIO_BIMC_M_NAV_PROF_ADDR_INV_MATCH_ADDR A:0x60415250
y.create.l HWIO_BIMC_M_NAV_PROF_ACH_MASK_0_ADDR A:0x60415260
y.create.l HWIO_BIMC_M_NAV_PROF_ACH_MATCH_0_ADDR A:0x60415264
y.create.l HWIO_BIMC_M_NAV_PROF_ACH_MASK_1_ADDR A:0x60415270
y.create.l HWIO_BIMC_M_NAV_PROF_ACH_MATCH_1_ADDR A:0x60415274
y.create.l HWIO_BIMC_M_NAV_PROF_ACH_INV_MATCH_1_ADDR A:0x60415278
y.create.l HWIO_BIMC_M_NAV_PROF_ACH_MASK_2_ADDR A:0x60415280
y.create.l HWIO_BIMC_M_NAV_PROF_ACH_MATCH_2_ADDR A:0x60415284
y.create.l HWIO_BIMC_M_NAV_PROF_ACH_MASK_3_ADDR A:0x60415290
y.create.l HWIO_BIMC_M_NAV_PROF_ACH_MATCH_3_ADDR A:0x60415294
y.create.l HWIO_BIMC_M_NAV_PROF_ACH_INV_MATCH_3_ADDR A:0x60415298
y.create.l HWIO_BIMC_M_NAV_PROF_ACH_MASK_4_ADDR A:0x604152a0
y.create.l HWIO_BIMC_M_NAV_PROF_ACH_MATCH_4_ADDR A:0x604152a4
y.create.l HWIO_BIMC_M_NAV_PROF_ACH_INV_MATCH_4_ADDR A:0x604152a8
y.create.l HWIO_BIMC_M_NAV_PROF_BCH_MASK_ADDR A:0x60415300
y.create.l HWIO_BIMC_M_NAV_PROF_BCH_MATCH_ADDR A:0x60415304
y.create.l HWIO_BIMC_M_NAV_PROF_BCH_INV_MATCH_ADDR A:0x60415308
y.create.l HWIO_BIMC_M_NAV_PROF_RCH_MASK_ADDR A:0x60415340
y.create.l HWIO_BIMC_M_NAV_PROF_RCH_MATCH_ADDR A:0x60415344
y.create.l HWIO_BIMC_M_NAV_PROF_RCH_INV_MATCH_ADDR A:0x60415348
y.create.l HWIO_BIMC_M_NAV_PROF_RD_STATUS_0_ADDR A:0x60415400
y.create.l HWIO_BIMC_M_NAV_PROF_WR_STATUS_0_ADDR A:0x60415410
y.create.l HWIO_BIMC_M_SYS_MPORT_COMPONENT_INFO_ADDR A:0x60418000
y.create.l HWIO_BIMC_M_SYS_MPORT_CONFIGURATION_INFO_0_ADDR A:0x60418020
y.create.l HWIO_BIMC_M_SYS_MPORT_CONFIGURATION_INFO_1_ADDR A:0x60418030
y.create.l HWIO_BIMC_M_SYS_MPORT_CONFIGURATION_INFO_2A_ADDR A:0x60418040
y.create.l HWIO_BIMC_M_SYS_MPORT_CONFIGURATION_INFO_2B_ADDR A:0x60418044
y.create.l HWIO_BIMC_M_SYS_MPORT_CONFIGURATION_INFO_3_ADDR A:0x60418050
y.create.l HWIO_BIMC_M_SYS_MPORT_CONFIGURATION_INFO_4_ADDR A:0x60418060
y.create.l HWIO_BIMC_M_SYS_MPORT_CONFIGURATION_INFO_5A_ADDR A:0x60418070
y.create.l HWIO_BIMC_M_SYS_MPORT_CONFIGURATION_INFO_5B_ADDR A:0x60418074
y.create.l HWIO_BIMC_M_SYS_MPORT_CONFIGURATION_INFO_5C_ADDR A:0x60418078
y.create.l HWIO_BIMC_M_SYS_MPORT_CONFIGURATION_INFO_5D_ADDR A:0x6041807c
y.create.l HWIO_BIMC_M_SYS_MPORT_INTERRUPT_STATUS_ADDR A:0x60418100
y.create.l HWIO_BIMC_M_SYS_MPORT_INTERRUPT_CLEAR_ADDR A:0x60418108
y.create.l HWIO_BIMC_M_SYS_MPORT_INTERRUPT_ENABLE_ADDR A:0x6041810c
y.create.l HWIO_BIMC_M_SYS_MPORT_CLOCK_CTRL_ADDR A:0x60418200
y.create.l HWIO_BIMC_M_SYS_MPORT_CDC_CTRL_ADDR A:0x60418208
y.create.l HWIO_BIMC_M_SYS_MPORT_MODE_ADDR A:0x60418210
y.create.l HWIO_BIMC_M_SYS_MPORT_WR_WAY_CROSSING_ADDR A:0x60418220
y.create.l HWIO_BIMC_M_SYS_MPORT_PRIORITYLVL_OVERRIDE_ADDR A:0x60418230
y.create.l HWIO_BIMC_M_SYS_MPORT_READ_COMMAND_OVERRIDE_ADDR A:0x60418240
y.create.l HWIO_BIMC_M_SYS_MPORT_WRITE_COMMAND_OVERRIDE_ADDR A:0x60418250
y.create.l HWIO_BIMC_M_SYS_MPORT_RD_TRACKING_INDEX_ADDR A:0x60418270
y.create.l HWIO_BIMC_M_SYS_MPORT_WR_TRACKING_INDEX_ADDR A:0x60418274
y.create.l HWIO_BIMC_M_SYS_MPORT_BWMON_ENABLE_ADDR A:0x60418280
y.create.l HWIO_BIMC_M_SYS_MPORT_BWMON_CLEAR_ADDR A:0x60418284
y.create.l HWIO_BIMC_M_SYS_MPORT_BWMON_BYTE_COUNT_ADDR A:0x60418288
y.create.l HWIO_BIMC_M_SYS_MPORT_BWMON_THRESHOLD_ADDR A:0x60418290
y.create.l HWIO_BIMC_M_SYS_MPORT_BWMON_MID_MASK_ADDR A:0x60418298
y.create.l HWIO_BIMC_M_SYS_MPORT_BWMON_MID_MATCH_ADDR A:0x6041829c
y.create.l HWIO_BIMC_M_SYS_MPORT_BKE_ENABLE_ADDR A:0x60418300
y.create.l HWIO_BIMC_M_SYS_MPORT_BKE_GRANT_PERIOD_ADDR A:0x60418304
y.create.l HWIO_BIMC_M_SYS_MPORT_BKE_GRANT_COUNT_ADDR A:0x60418308
y.create.l HWIO_BIMC_M_SYS_MPORT_BKE_THRESHOLD_HIGH_ADDR A:0x60418320
y.create.l HWIO_BIMC_M_SYS_MPORT_BKE_THRESHOLD_MEDIUM_ADDR A:0x60418324
y.create.l HWIO_BIMC_M_SYS_MPORT_BKE_THRESHOLD_LOW_ADDR A:0x60418328
y.create.l HWIO_BIMC_M_SYS_MPORT_BKE_HEALTH_0_ADDR A:0x60418340
y.create.l HWIO_BIMC_M_SYS_MPORT_BKE_HEALTH_1_ADDR A:0x60418344
y.create.l HWIO_BIMC_M_SYS_MPORT_BKE_HEALTH_2_ADDR A:0x60418348
y.create.l HWIO_BIMC_M_SYS_MPORT_BKE_HEALTH_3_ADDR A:0x6041834c
y.create.l HWIO_BIMC_M_SYS_MPORT_STATUS_2A_ADDR A:0x60418420
y.create.l HWIO_BIMC_M_SYS_MPORT_STATUS_2B_ADDR A:0x60418424
y.create.l HWIO_BIMC_M_SYS_MPORT_STATUS_3A_ADDR A:0x60418430
y.create.l HWIO_BIMC_M_SYS_MPORT_STATUS_3B_ADDR A:0x60418434
y.create.l HWIO_BIMC_M_SYS_MPORT_BKE1_ENABLE_ADDR A:0x60418800
y.create.l HWIO_BIMC_M_SYS_MPORT_BKE1_GRANT_PERIOD_ADDR A:0x60418804
y.create.l HWIO_BIMC_M_SYS_MPORT_BKE1_GRANT_COUNT_ADDR A:0x60418808
y.create.l HWIO_BIMC_M_SYS_MPORT_BKE1_THRESHOLD_HIGH_ADDR A:0x60418820
y.create.l HWIO_BIMC_M_SYS_MPORT_BKE1_THRESHOLD_MEDIUM_ADDR A:0x60418824
y.create.l HWIO_BIMC_M_SYS_MPORT_BKE1_THRESHOLD_LOW_ADDR A:0x60418828
y.create.l HWIO_BIMC_M_SYS_MPORT_BKE1_HEALTH_0_ADDR A:0x60418840
y.create.l HWIO_BIMC_M_SYS_MPORT_BKE1_HEALTH_1_ADDR A:0x60418844
y.create.l HWIO_BIMC_M_SYS_MPORT_BKE1_HEALTH_2_ADDR A:0x60418848
y.create.l HWIO_BIMC_M_SYS_MPORT_BKE1_HEALTH_3_ADDR A:0x6041884c
y.create.l HWIO_BIMC_M_SYS_MPORT_BKE2_ENABLE_ADDR A:0x60418900
y.create.l HWIO_BIMC_M_SYS_MPORT_BKE2_GRANT_PERIOD_ADDR A:0x60418904
y.create.l HWIO_BIMC_M_SYS_MPORT_BKE2_GRANT_COUNT_ADDR A:0x60418908
y.create.l HWIO_BIMC_M_SYS_MPORT_BKE2_THRESHOLD_HIGH_ADDR A:0x60418920
y.create.l HWIO_BIMC_M_SYS_MPORT_BKE2_THRESHOLD_MEDIUM_ADDR A:0x60418924
y.create.l HWIO_BIMC_M_SYS_MPORT_BKE2_THRESHOLD_LOW_ADDR A:0x60418928
y.create.l HWIO_BIMC_M_SYS_MPORT_BKE2_HEALTH_0_ADDR A:0x60418940
y.create.l HWIO_BIMC_M_SYS_MPORT_BKE2_HEALTH_1_ADDR A:0x60418944
y.create.l HWIO_BIMC_M_SYS_MPORT_BKE2_HEALTH_2_ADDR A:0x60418948
y.create.l HWIO_BIMC_M_SYS_MPORT_BKE2_HEALTH_3_ADDR A:0x6041894c
y.create.l HWIO_BIMC_M_SYS_MPORT_BKE3_ENABLE_ADDR A:0x60418a00
y.create.l HWIO_BIMC_M_SYS_MPORT_BKE3_GRANT_PERIOD_ADDR A:0x60418a04
y.create.l HWIO_BIMC_M_SYS_MPORT_BKE3_GRANT_COUNT_ADDR A:0x60418a08
y.create.l HWIO_BIMC_M_SYS_MPORT_BKE3_THRESHOLD_HIGH_ADDR A:0x60418a20
y.create.l HWIO_BIMC_M_SYS_MPORT_BKE3_THRESHOLD_MEDIUM_ADDR A:0x60418a24
y.create.l HWIO_BIMC_M_SYS_MPORT_BKE3_THRESHOLD_LOW_ADDR A:0x60418a28
y.create.l HWIO_BIMC_M_SYS_MPORT_BKE3_HEALTH_0_ADDR A:0x60418a40
y.create.l HWIO_BIMC_M_SYS_MPORT_BKE3_HEALTH_1_ADDR A:0x60418a44
y.create.l HWIO_BIMC_M_SYS_MPORT_BKE3_HEALTH_2_ADDR A:0x60418a48
y.create.l HWIO_BIMC_M_SYS_MPORT_BKE3_HEALTH_3_ADDR A:0x60418a4c
y.create.l HWIO_BIMC_M_SYS_PROF_COMPONENT_INFO_ADDR A:0x60419000
y.create.l HWIO_BIMC_M_SYS_PROF_CONFIGURATION_INFO_0_ADDR A:0x60419020
y.create.l HWIO_BIMC_M_SYS_PROF_CONFIGURATION_INFO_1_ADDR A:0x60419030
y.create.l HWIO_BIMC_M_SYS_PROF_CLOCK_CTRL_ADDR A:0x60419200
y.create.l HWIO_BIMC_M_SYS_PROF_MODE_ADDR A:0x60419210
y.create.l HWIO_BIMC_M_SYS_PROF_RD_TENURE_THRESHOLD_ADDR A:0x60419214
y.create.l HWIO_BIMC_M_SYS_PROF_WR_TENURE_THRESHOLD_ADDR A:0x60419218
y.create.l HWIO_BIMC_M_SYS_PROF_SWAY_SELECT_ADDR A:0x60419220
y.create.l HWIO_BIMC_M_SYS_PROF_MID_MASK_ADDR A:0x60419230
y.create.l HWIO_BIMC_M_SYS_PROF_MID_MATCH_ADDR A:0x60419234
y.create.l HWIO_BIMC_M_SYS_PROF_MID_INV_MATCH_ADDR A:0x60419238
y.create.l HWIO_BIMC_M_SYS_PROF_ADDR_MASK_LOWER_ADDR A:0x60419240
y.create.l HWIO_BIMC_M_SYS_PROF_ADDR_MASK_UPPER_ADDR A:0x60419244
y.create.l HWIO_BIMC_M_SYS_PROF_ADDR_MATCH_LOWER_ADDR A:0x60419248
y.create.l HWIO_BIMC_M_SYS_PROF_ADDR_MATCH_UPPER_ADDR A:0x6041924c
y.create.l HWIO_BIMC_M_SYS_PROF_ADDR_INV_MATCH_ADDR A:0x60419250
y.create.l HWIO_BIMC_M_SYS_PROF_ACH_MASK_0_ADDR A:0x60419260
y.create.l HWIO_BIMC_M_SYS_PROF_ACH_MATCH_0_ADDR A:0x60419264
y.create.l HWIO_BIMC_M_SYS_PROF_ACH_MASK_1_ADDR A:0x60419270
y.create.l HWIO_BIMC_M_SYS_PROF_ACH_MATCH_1_ADDR A:0x60419274
y.create.l HWIO_BIMC_M_SYS_PROF_ACH_INV_MATCH_1_ADDR A:0x60419278
y.create.l HWIO_BIMC_M_SYS_PROF_ACH_MASK_2_ADDR A:0x60419280
y.create.l HWIO_BIMC_M_SYS_PROF_ACH_MATCH_2_ADDR A:0x60419284
y.create.l HWIO_BIMC_M_SYS_PROF_ACH_MASK_3_ADDR A:0x60419290
y.create.l HWIO_BIMC_M_SYS_PROF_ACH_MATCH_3_ADDR A:0x60419294
y.create.l HWIO_BIMC_M_SYS_PROF_ACH_INV_MATCH_3_ADDR A:0x60419298
y.create.l HWIO_BIMC_M_SYS_PROF_ACH_MASK_4_ADDR A:0x604192a0
y.create.l HWIO_BIMC_M_SYS_PROF_ACH_MATCH_4_ADDR A:0x604192a4
y.create.l HWIO_BIMC_M_SYS_PROF_ACH_INV_MATCH_4_ADDR A:0x604192a8
y.create.l HWIO_BIMC_M_SYS_PROF_BCH_MASK_ADDR A:0x60419300
y.create.l HWIO_BIMC_M_SYS_PROF_BCH_MATCH_ADDR A:0x60419304
y.create.l HWIO_BIMC_M_SYS_PROF_BCH_INV_MATCH_ADDR A:0x60419308
y.create.l HWIO_BIMC_M_SYS_PROF_RCH_MASK_ADDR A:0x60419340
y.create.l HWIO_BIMC_M_SYS_PROF_RCH_MATCH_ADDR A:0x60419344
y.create.l HWIO_BIMC_M_SYS_PROF_RCH_INV_MATCH_ADDR A:0x60419348
y.create.l HWIO_BIMC_M_SYS_PROF_RD_STATUS_0_ADDR A:0x60419400
y.create.l HWIO_BIMC_M_SYS_PROF_WR_STATUS_0_ADDR A:0x60419410
y.create.l HWIO_BIMC_M_TCU_MPORT_COMPONENT_INFO_ADDR A:0x6041c000
y.create.l HWIO_BIMC_M_TCU_MPORT_CONFIGURATION_INFO_0_ADDR A:0x6041c020
y.create.l HWIO_BIMC_M_TCU_MPORT_CONFIGURATION_INFO_1_ADDR A:0x6041c030
y.create.l HWIO_BIMC_M_TCU_MPORT_CONFIGURATION_INFO_2A_ADDR A:0x6041c040
y.create.l HWIO_BIMC_M_TCU_MPORT_CONFIGURATION_INFO_2B_ADDR A:0x6041c044
y.create.l HWIO_BIMC_M_TCU_MPORT_CONFIGURATION_INFO_3_ADDR A:0x6041c050
y.create.l HWIO_BIMC_M_TCU_MPORT_CONFIGURATION_INFO_4_ADDR A:0x6041c060
y.create.l HWIO_BIMC_M_TCU_MPORT_CONFIGURATION_INFO_5A_ADDR A:0x6041c070
y.create.l HWIO_BIMC_M_TCU_MPORT_CONFIGURATION_INFO_5B_ADDR A:0x6041c074
y.create.l HWIO_BIMC_M_TCU_MPORT_CONFIGURATION_INFO_5C_ADDR A:0x6041c078
y.create.l HWIO_BIMC_M_TCU_MPORT_CONFIGURATION_INFO_5D_ADDR A:0x6041c07c
y.create.l HWIO_BIMC_M_TCU_MPORT_INTERRUPT_STATUS_ADDR A:0x6041c100
y.create.l HWIO_BIMC_M_TCU_MPORT_INTERRUPT_CLEAR_ADDR A:0x6041c108
y.create.l HWIO_BIMC_M_TCU_MPORT_INTERRUPT_ENABLE_ADDR A:0x6041c10c
y.create.l HWIO_BIMC_M_TCU_MPORT_CLOCK_CTRL_ADDR A:0x6041c200
y.create.l HWIO_BIMC_M_TCU_MPORT_CDC_CTRL_ADDR A:0x6041c208
y.create.l HWIO_BIMC_M_TCU_MPORT_MODE_ADDR A:0x6041c210
y.create.l HWIO_BIMC_M_TCU_MPORT_WR_WAY_CROSSING_ADDR A:0x6041c220
y.create.l HWIO_BIMC_M_TCU_MPORT_PRIORITYLVL_OVERRIDE_ADDR A:0x6041c230
y.create.l HWIO_BIMC_M_TCU_MPORT_READ_COMMAND_OVERRIDE_ADDR A:0x6041c240
y.create.l HWIO_BIMC_M_TCU_MPORT_WRITE_COMMAND_OVERRIDE_ADDR A:0x6041c250
y.create.l HWIO_BIMC_M_TCU_MPORT_RD_TRACKING_INDEX_ADDR A:0x6041c270
y.create.l HWIO_BIMC_M_TCU_MPORT_WR_TRACKING_INDEX_ADDR A:0x6041c274
y.create.l HWIO_BIMC_M_TCU_MPORT_BWMON_ENABLE_ADDR A:0x6041c280
y.create.l HWIO_BIMC_M_TCU_MPORT_BWMON_CLEAR_ADDR A:0x6041c284
y.create.l HWIO_BIMC_M_TCU_MPORT_BWMON_BYTE_COUNT_ADDR A:0x6041c288
y.create.l HWIO_BIMC_M_TCU_MPORT_BWMON_THRESHOLD_ADDR A:0x6041c290
y.create.l HWIO_BIMC_M_TCU_MPORT_BWMON_MID_MASK_ADDR A:0x6041c298
y.create.l HWIO_BIMC_M_TCU_MPORT_BWMON_MID_MATCH_ADDR A:0x6041c29c
y.create.l HWIO_BIMC_M_TCU_MPORT_BKE_ENABLE_ADDR A:0x6041c300
y.create.l HWIO_BIMC_M_TCU_MPORT_BKE_GRANT_PERIOD_ADDR A:0x6041c304
y.create.l HWIO_BIMC_M_TCU_MPORT_BKE_GRANT_COUNT_ADDR A:0x6041c308
y.create.l HWIO_BIMC_M_TCU_MPORT_BKE_THRESHOLD_HIGH_ADDR A:0x6041c320
y.create.l HWIO_BIMC_M_TCU_MPORT_BKE_THRESHOLD_MEDIUM_ADDR A:0x6041c324
y.create.l HWIO_BIMC_M_TCU_MPORT_BKE_THRESHOLD_LOW_ADDR A:0x6041c328
y.create.l HWIO_BIMC_M_TCU_MPORT_BKE_HEALTH_0_ADDR A:0x6041c340
y.create.l HWIO_BIMC_M_TCU_MPORT_BKE_HEALTH_1_ADDR A:0x6041c344
y.create.l HWIO_BIMC_M_TCU_MPORT_BKE_HEALTH_2_ADDR A:0x6041c348
y.create.l HWIO_BIMC_M_TCU_MPORT_BKE_HEALTH_3_ADDR A:0x6041c34c
y.create.l HWIO_BIMC_M_TCU_MPORT_STATUS_2A_ADDR A:0x6041c420
y.create.l HWIO_BIMC_M_TCU_MPORT_STATUS_2B_ADDR A:0x6041c424
y.create.l HWIO_BIMC_M_TCU_MPORT_STATUS_3A_ADDR A:0x6041c430
y.create.l HWIO_BIMC_M_TCU_MPORT_STATUS_3B_ADDR A:0x6041c434
y.create.l HWIO_BIMC_M_TCU_MPORT_BKE1_ENABLE_ADDR A:0x6041c800
y.create.l HWIO_BIMC_M_TCU_MPORT_BKE1_GRANT_PERIOD_ADDR A:0x6041c804
y.create.l HWIO_BIMC_M_TCU_MPORT_BKE1_GRANT_COUNT_ADDR A:0x6041c808
y.create.l HWIO_BIMC_M_TCU_MPORT_BKE1_THRESHOLD_HIGH_ADDR A:0x6041c820
y.create.l HWIO_BIMC_M_TCU_MPORT_BKE1_THRESHOLD_MEDIUM_ADDR A:0x6041c824
y.create.l HWIO_BIMC_M_TCU_MPORT_BKE1_THRESHOLD_LOW_ADDR A:0x6041c828
y.create.l HWIO_BIMC_M_TCU_MPORT_BKE1_HEALTH_0_ADDR A:0x6041c840
y.create.l HWIO_BIMC_M_TCU_MPORT_BKE1_HEALTH_1_ADDR A:0x6041c844
y.create.l HWIO_BIMC_M_TCU_MPORT_BKE1_HEALTH_2_ADDR A:0x6041c848
y.create.l HWIO_BIMC_M_TCU_MPORT_BKE1_HEALTH_3_ADDR A:0x6041c84c
y.create.l HWIO_BIMC_M_TCU_MPORT_BKE2_ENABLE_ADDR A:0x6041c900
y.create.l HWIO_BIMC_M_TCU_MPORT_BKE2_GRANT_PERIOD_ADDR A:0x6041c904
y.create.l HWIO_BIMC_M_TCU_MPORT_BKE2_GRANT_COUNT_ADDR A:0x6041c908
y.create.l HWIO_BIMC_M_TCU_MPORT_BKE2_THRESHOLD_HIGH_ADDR A:0x6041c920
y.create.l HWIO_BIMC_M_TCU_MPORT_BKE2_THRESHOLD_MEDIUM_ADDR A:0x6041c924
y.create.l HWIO_BIMC_M_TCU_MPORT_BKE2_THRESHOLD_LOW_ADDR A:0x6041c928
y.create.l HWIO_BIMC_M_TCU_MPORT_BKE2_HEALTH_0_ADDR A:0x6041c940
y.create.l HWIO_BIMC_M_TCU_MPORT_BKE2_HEALTH_1_ADDR A:0x6041c944
y.create.l HWIO_BIMC_M_TCU_MPORT_BKE2_HEALTH_2_ADDR A:0x6041c948
y.create.l HWIO_BIMC_M_TCU_MPORT_BKE2_HEALTH_3_ADDR A:0x6041c94c
y.create.l HWIO_BIMC_M_TCU_MPORT_BKE3_ENABLE_ADDR A:0x6041ca00
y.create.l HWIO_BIMC_M_TCU_MPORT_BKE3_GRANT_PERIOD_ADDR A:0x6041ca04
y.create.l HWIO_BIMC_M_TCU_MPORT_BKE3_GRANT_COUNT_ADDR A:0x6041ca08
y.create.l HWIO_BIMC_M_TCU_MPORT_BKE3_THRESHOLD_HIGH_ADDR A:0x6041ca20
y.create.l HWIO_BIMC_M_TCU_MPORT_BKE3_THRESHOLD_MEDIUM_ADDR A:0x6041ca24
y.create.l HWIO_BIMC_M_TCU_MPORT_BKE3_THRESHOLD_LOW_ADDR A:0x6041ca28
y.create.l HWIO_BIMC_M_TCU_MPORT_BKE3_HEALTH_0_ADDR A:0x6041ca40
y.create.l HWIO_BIMC_M_TCU_MPORT_BKE3_HEALTH_1_ADDR A:0x6041ca44
y.create.l HWIO_BIMC_M_TCU_MPORT_BKE3_HEALTH_2_ADDR A:0x6041ca48
y.create.l HWIO_BIMC_M_TCU_MPORT_BKE3_HEALTH_3_ADDR A:0x6041ca4c
y.create.l HWIO_BIMC_M_TCU_PROF_COMPONENT_INFO_ADDR A:0x6041d000
y.create.l HWIO_BIMC_M_TCU_PROF_CONFIGURATION_INFO_0_ADDR A:0x6041d020
y.create.l HWIO_BIMC_M_TCU_PROF_CONFIGURATION_INFO_1_ADDR A:0x6041d030
y.create.l HWIO_BIMC_M_TCU_PROF_CLOCK_CTRL_ADDR A:0x6041d200
y.create.l HWIO_BIMC_M_TCU_PROF_MODE_ADDR A:0x6041d210
y.create.l HWIO_BIMC_M_TCU_PROF_RD_TENURE_THRESHOLD_ADDR A:0x6041d214
y.create.l HWIO_BIMC_M_TCU_PROF_WR_TENURE_THRESHOLD_ADDR A:0x6041d218
y.create.l HWIO_BIMC_M_TCU_PROF_SWAY_SELECT_ADDR A:0x6041d220
y.create.l HWIO_BIMC_M_TCU_PROF_MID_MASK_ADDR A:0x6041d230
y.create.l HWIO_BIMC_M_TCU_PROF_MID_MATCH_ADDR A:0x6041d234
y.create.l HWIO_BIMC_M_TCU_PROF_MID_INV_MATCH_ADDR A:0x6041d238
y.create.l HWIO_BIMC_M_TCU_PROF_ADDR_MASK_LOWER_ADDR A:0x6041d240
y.create.l HWIO_BIMC_M_TCU_PROF_ADDR_MASK_UPPER_ADDR A:0x6041d244
y.create.l HWIO_BIMC_M_TCU_PROF_ADDR_MATCH_LOWER_ADDR A:0x6041d248
y.create.l HWIO_BIMC_M_TCU_PROF_ADDR_MATCH_UPPER_ADDR A:0x6041d24c
y.create.l HWIO_BIMC_M_TCU_PROF_ADDR_INV_MATCH_ADDR A:0x6041d250
y.create.l HWIO_BIMC_M_TCU_PROF_ACH_MASK_0_ADDR A:0x6041d260
y.create.l HWIO_BIMC_M_TCU_PROF_ACH_MATCH_0_ADDR A:0x6041d264
y.create.l HWIO_BIMC_M_TCU_PROF_ACH_MASK_1_ADDR A:0x6041d270
y.create.l HWIO_BIMC_M_TCU_PROF_ACH_MATCH_1_ADDR A:0x6041d274
y.create.l HWIO_BIMC_M_TCU_PROF_ACH_INV_MATCH_1_ADDR A:0x6041d278
y.create.l HWIO_BIMC_M_TCU_PROF_ACH_MASK_2_ADDR A:0x6041d280
y.create.l HWIO_BIMC_M_TCU_PROF_ACH_MATCH_2_ADDR A:0x6041d284
y.create.l HWIO_BIMC_M_TCU_PROF_ACH_MASK_3_ADDR A:0x6041d290
y.create.l HWIO_BIMC_M_TCU_PROF_ACH_MATCH_3_ADDR A:0x6041d294
y.create.l HWIO_BIMC_M_TCU_PROF_ACH_INV_MATCH_3_ADDR A:0x6041d298
y.create.l HWIO_BIMC_M_TCU_PROF_ACH_MASK_4_ADDR A:0x6041d2a0
y.create.l HWIO_BIMC_M_TCU_PROF_ACH_MATCH_4_ADDR A:0x6041d2a4
y.create.l HWIO_BIMC_M_TCU_PROF_ACH_INV_MATCH_4_ADDR A:0x6041d2a8
y.create.l HWIO_BIMC_M_TCU_PROF_BCH_MASK_ADDR A:0x6041d300
y.create.l HWIO_BIMC_M_TCU_PROF_BCH_MATCH_ADDR A:0x6041d304
y.create.l HWIO_BIMC_M_TCU_PROF_BCH_INV_MATCH_ADDR A:0x6041d308
y.create.l HWIO_BIMC_M_TCU_PROF_RCH_MASK_ADDR A:0x6041d340
y.create.l HWIO_BIMC_M_TCU_PROF_RCH_MATCH_ADDR A:0x6041d344
y.create.l HWIO_BIMC_M_TCU_PROF_RCH_INV_MATCH_ADDR A:0x6041d348
y.create.l HWIO_BIMC_M_TCU_PROF_RD_STATUS_0_ADDR A:0x6041d400
y.create.l HWIO_BIMC_M_TCU_PROF_WR_STATUS_0_ADDR A:0x6041d410
y.create.l HWIO_BIMC_S_SYS_SWAY_COMPONENT_INFO_ADDR A:0x60450000
y.create.l HWIO_BIMC_S_SYS_SWAY_CONFIGURATION_INFO_0_ADDR A:0x60450020
y.create.l HWIO_BIMC_S_SYS_SWAY_CONFIGURATION_INFO_1_ADDR A:0x60450030
y.create.l HWIO_BIMC_S_SYS_SWAY_CONFIGURATION_INFO_2_ADDR A:0x60450040
y.create.l HWIO_BIMC_S_SYS_SWAY_CONFIGURATION_INFO_3_ADDR A:0x60450050
y.create.l HWIO_BIMC_S_SYS_SWAY_CONFIGURATION_INFO_4_ADDR A:0x60450060
y.create.l HWIO_BIMC_S_SYS_SWAY_CONFIGURATION_INFO_5_ADDR A:0x60450070
y.create.l HWIO_BIMC_S_SYS_SWAY_CONFIGURATION_INFO_6A_ADDR A:0x60450080
y.create.l HWIO_BIMC_S_SYS_SWAY_CONFIGURATION_INFO_6B_ADDR A:0x60450084
y.create.l HWIO_BIMC_S_SYS_SWAY_CONFIGURATION_INFO_6C_ADDR A:0x60450088
y.create.l HWIO_BIMC_S_SYS_SWAY_CONFIGURATION_INFO_6D_ADDR A:0x6045008c
y.create.l HWIO_BIMC_S_SYS_SWAY_INTERRUPT_STATUS_ADDR A:0x60450100
y.create.l HWIO_BIMC_S_SYS_SWAY_INTERRUPT_CLEAR_ADDR A:0x60450108
y.create.l HWIO_BIMC_S_SYS_SWAY_INTERRUPT_ENABLE_ADDR A:0x6045010c
y.create.l HWIO_BIMC_S_SYS_SWAY_CLOCK_CTRL_ADDR A:0x60450200
y.create.l HWIO_BIMC_S_SYS_SWAY_CDC_CTRL_ADDR A:0x60450208
y.create.l HWIO_BIMC_S_SYS_SWAY_RCH_SELECT_ADDR A:0x60450210
y.create.l HWIO_BIMC_S_SYS_SWAY_MAX_OUTSTANDING_REQUESTS_ADDR A:0x60450220
y.create.l HWIO_BIMC_S_SYS_SWAY_GATHERING_ADDR A:0x60450230
y.create.l HWIO_BIMC_S_SYS_SWAY_MODE_ADDR A:0x60450240
y.create.l HWIO_BIMC_S_SYS_SWAY_READ_COMMAND_OVERRIDE_ADDR A:0x60450250
y.create.l HWIO_BIMC_S_SYS_SWAY_WRITE_COMMAND_OVERRIDE_ADDR A:0x60450260
y.create.l HWIO_BIMC_S_SYS_SWAY_STATUS_0A_ADDR A:0x60450400
y.create.l HWIO_BIMC_S_SYS_SWAY_STATUS_0B_ADDR A:0x60450404
y.create.l HWIO_BIMC_S_SYS_SWAY_STATUS_0C_ADDR A:0x60450408
y.create.l HWIO_BIMC_S_SYS_SWAY_STATUS_0D_ADDR A:0x6045040c
y.create.l HWIO_BIMC_S_SYS_SWAY_STATUS_1A_ADDR A:0x60450410
y.create.l HWIO_BIMC_S_SYS_SWAY_STATUS_1B_ADDR A:0x60450414
y.create.l HWIO_BIMC_S_SYS_SWAY_STATUS_1C_ADDR A:0x60450418
y.create.l HWIO_BIMC_S_DEFAULT_SWAY_COMPONENT_INFO_ADDR A:0x60458000
y.create.l HWIO_BIMC_S_DEFAULT_SWAY_CONFIGURATION_INFO_0_ADDR A:0x60458020
y.create.l HWIO_BIMC_S_DEFAULT_SWAY_CONFIGURATION_INFO_1_ADDR A:0x60458030
y.create.l HWIO_BIMC_S_DEFAULT_SWAY_INTERRUPT_STATUS_ADDR A:0x60458100
y.create.l HWIO_BIMC_S_DEFAULT_SWAY_INTERRUPT_CLEAR_ADDR A:0x60458108
y.create.l HWIO_BIMC_S_DEFAULT_SWAY_INTERRUPT_ENABLE_ADDR A:0x6045810c
y.create.l HWIO_BIMC_S_DEFAULT_SWAY_DEFAULT_SLAVE_STATUS_0_ADDR A:0x60458400
y.create.l HWIO_BIMC_S_DEFAULT_SWAY_DEFAULT_SLAVE_STATUS_1_ADDR A:0x60458410
y.create.l HWIO_BIMC_S_DEFAULT_SWAY_DEFAULT_SLAVE_STATUS_2_ADDR A:0x60458420
y.create.l HWIO_BIMC_S_DDR0_ARB_COMPONENT_INFO_ADDR A:0x60449000
y.create.l HWIO_BIMC_S_DDR0_ARB_CONFIGURATION_INFO_0_ADDR A:0x60449020
y.create.l HWIO_BIMC_S_DDR0_ARB_CONFIGURATION_INFO_1_ADDR A:0x60449030
y.create.l HWIO_BIMC_S_DDR0_ARB_CLOCK_CTRL_ADDR A:0x60449200
y.create.l HWIO_BIMC_S_DDR0_ARB_MODE_ADDR A:0x60449210
y.create.l HWIO_BIMC_S_DDR0_ARB_MASTER0_GRANTS_ADDR A:0x60449220
y.create.l HWIO_BIMC_S_DDR0_ARB_MASTER1_GRANTS_ADDR A:0x60449224
y.create.l HWIO_BIMC_S_DDR0_ARB_MASTER2_GRANTS_ADDR A:0x60449228
y.create.l HWIO_BIMC_S_DDR0_ARB_MASTER3_GRANTS_ADDR A:0x6044922c
y.create.l HWIO_BIMC_S_DDR0_ARB_MASTER4_GRANTS_ADDR A:0x60449230
y.create.l HWIO_BIMC_S_DDR0_ARB_MASTER5_GRANTS_ADDR A:0x60449234
y.create.l HWIO_BIMC_S_SYS_ARB_COMPONENT_INFO_ADDR A:0x60451000
y.create.l HWIO_BIMC_S_SYS_ARB_CONFIGURATION_INFO_0_ADDR A:0x60451020
y.create.l HWIO_BIMC_S_SYS_ARB_CONFIGURATION_INFO_1_ADDR A:0x60451030
y.create.l HWIO_BIMC_S_SYS_ARB_CLOCK_CTRL_ADDR A:0x60451200
y.create.l HWIO_BIMC_S_SYS_ARB_MODE_ADDR A:0x60451210
y.create.l HWIO_BIMC_S_DEFAULT_ARB_COMPONENT_INFO_ADDR A:0x60459000
y.create.l HWIO_BIMC_S_DEFAULT_ARB_CONFIGURATION_INFO_0_ADDR A:0x60459020
y.create.l HWIO_BIMC_S_DEFAULT_ARB_CONFIGURATION_INFO_1_ADDR A:0x60459030
y.create.l HWIO_BIMC_S_DEFAULT_ARB_CLOCK_CTRL_ADDR A:0x60459200
y.create.l HWIO_BIMC_S_DEFAULT_ARB_MODE_ADDR A:0x60459210
y.create.l HWIO_BIMC_S_DDR0_SCMO_COMPONENT_INFO_ADDR A:0x60448000
y.create.l HWIO_BIMC_S_DDR0_SCMO_HW_INFO_ADDR A:0x60448010
y.create.l HWIO_BIMC_S_DDR0_SCMO_CONFIGURATION_INFO_0_ADDR A:0x60448020
y.create.l HWIO_BIMC_S_DDR0_SCMO_CONFIGURATION_INFO_1_ADDR A:0x60448030
y.create.l HWIO_BIMC_S_DDR0_SCMO_CONFIGURATION_INFO_2_ADDR A:0x60448040
y.create.l HWIO_BIMC_S_DDR0_SCMO_CONFIGURATION_INFO_3_ADDR A:0x60448050
y.create.l HWIO_BIMC_S_DDR0_SCMO_CONFIGURATION_INFO_4_ADDR A:0x60448060
y.create.l HWIO_BIMC_S_DDR0_SCMO_CONFIGURATION_INFO_5_ADDR A:0x60448070
y.create.l HWIO_BIMC_S_DDR0_SCMO_CONFIGURATION_INFO_6_ADDR A:0x60448080
y.create.l HWIO_BIMC_S_DDR0_SCMO_INTERRUPT_STATUS_ADDR A:0x60448100
y.create.l HWIO_BIMC_S_DDR0_SCMO_INTERRUPT_CLEAR_ADDR A:0x60448108
y.create.l HWIO_BIMC_S_DDR0_SCMO_INTERRUPT_ENABLE_ADDR A:0x6044810c
y.create.l HWIO_BIMC_S_DDR0_SCMO_ESYN_ADDR_ADDR A:0x60448120
y.create.l HWIO_BIMC_S_DDR0_SCMO_ESYN_APACKET_0_ADDR A:0x60448128
y.create.l HWIO_BIMC_S_DDR0_SCMO_ESYN_APACKET_1_ADDR A:0x6044812c
y.create.l HWIO_BIMC_S_DDR0_SCMO_ESYN_APACKET_2_ADDR A:0x60448130
y.create.l HWIO_BIMC_S_DDR0_SCMO_CLOCK_CTRL_ADDR A:0x60448200
y.create.l HWIO_BIMC_S_DDR0_SCMO_SLV_INTERLEAVE_CFG_ADDR A:0x60448400
y.create.l HWIO_BIMC_S_DDR0_SCMO_ADDR_BASE_CS0_ADDR A:0x60448410
y.create.l HWIO_BIMC_S_DDR0_SCMO_ADDR_BASE_CS1_ADDR A:0x60448414
y.create.l HWIO_BIMC_S_DDR0_SCMO_ADDR_MAP_CS0_ADDR A:0x60448420
y.create.l HWIO_BIMC_S_DDR0_SCMO_ADDR_MAP_CS1_ADDR A:0x60448424
y.create.l HWIO_BIMC_S_DDR0_SCMO_ADDR_MASK_CS0_ADDR A:0x60448430
y.create.l HWIO_BIMC_S_DDR0_SCMO_ADDR_MASK_CS1_ADDR A:0x60448434
y.create.l HWIO_BIMC_S_DDR0_SCMO_SLV_STATUS_ADDR A:0x60448450
y.create.l HWIO_BIMC_S_DDR0_SCMO_GLOBAL_MON_CFG_ADDR A:0x60448460
y.create.l HWIO_BIMC_S_DDR0_SCMO_CMD_BUF_CFG_ADDR A:0x60448500
y.create.l HWIO_BIMC_S_DDR0_SCMO_CMD_BUF_STATUS_ADDR A:0x60448520
y.create.l HWIO_BIMC_S_DDR0_SCMO_RCH_SELECT_ADDR A:0x60448540
y.create.l HWIO_BIMC_S_DDR0_SCMO_RCH_BKPR_CFG_ADDR A:0x60448544
y.create.l HWIO_BIMC_S_DDR0_SCMO_RCH_STATUS_ADDR A:0x60448560
y.create.l HWIO_BIMC_S_DDR0_SCMO_WCH_BUF_CFG_ADDR A:0x60448580
y.create.l HWIO_BIMC_S_DDR0_SCMO_WCH_STATUS_ADDR A:0x604485a0
y.create.l HWIO_BIMC_S_DDR0_SCMO_FLUSH_CFG_ADDR A:0x604485c0
y.create.l HWIO_BIMC_S_DDR0_SCMO_FLUSH_CMD_ADDR A:0x604485c4
y.create.l HWIO_BIMC_S_DDR0_SCMO_CMD_OPT_CFG0_ADDR A:0x60448700
y.create.l HWIO_BIMC_S_DDR0_SCMO_CMD_OPT_CFG1_ADDR A:0x60448704
y.create.l HWIO_BIMC_S_DDR0_SCMO_CMD_OPT_CFG2_ADDR A:0x60448708
y.create.l HWIO_BIMC_S_DDR0_SCMO_CMD_OPT_CFG3_ADDR A:0x6044870c
y.create.l HWIO_BIMC_S_DDR0_SCMO_CMD_OPT_CFG4_ADDR A:0x60448710
y.create.l HWIO_BIMC_S_DDR0_SCMO_FSP_STATUS_ADDR A:0x60448a40
y.create.l HWIO_BIMC_S_DDR0_XPU_SCR_ADDR A:0x6044a000
y.create.l HWIO_BIMC_S_DDR0_XPU_SWDR_ADDR A:0x6044a004
y.create.l HWIO_BIMC_S_DDR0_XPU_PRTN_RACR_SSHADOW_ADDR A:0x6044a008
y.create.l HWIO_BIMC_S_DDR0_XPU_PRTN_WACR_SSHADOW_ADDR A:0x6044a00c
y.create.l HWIO_BIMC_S_DDR0_XPU_PRTN_START_SSHADOW0_ADDR A:0x6044a010
y.create.l HWIO_BIMC_S_DDR0_XPU_PRTN_END_SSHADOW0_ADDR A:0x6044a018
y.create.l HWIO_BIMC_S_DDR0_XPU_SEAR0_ADDR A:0x6044a040
y.create.l HWIO_BIMC_S_DDR0_XPU_SESR_ADDR A:0x6044a048
y.create.l HWIO_BIMC_S_DDR0_XPU_SESRRESTORE_ADDR A:0x6044a04c
y.create.l HWIO_BIMC_S_DDR0_XPU_SESYNR0_ADDR A:0x6044a050
y.create.l HWIO_BIMC_S_DDR0_XPU_SESYNR1_ADDR A:0x6044a054
y.create.l HWIO_BIMC_S_DDR0_XPU_SESYNR2_ADDR A:0x6044a058
y.create.l HWIO_BIMC_S_DDR0_XPU_MCR_ADDR A:0x6044a100
y.create.l HWIO_BIMC_S_DDR0_XPU_MEAR0_ADDR A:0x6044a140
y.create.l HWIO_BIMC_S_DDR0_XPU_MESR_ADDR A:0x6044a148
y.create.l HWIO_BIMC_S_DDR0_XPU_MESRRESTORE_ADDR A:0x6044a14c
y.create.l HWIO_BIMC_S_DDR0_XPU_MESYNR0_ADDR A:0x6044a150
y.create.l HWIO_BIMC_S_DDR0_XPU_MESYNR1_ADDR A:0x6044a154
y.create.l HWIO_BIMC_S_DDR0_XPU_MESYNR2_ADDR A:0x6044a158
y.create.l HWIO_BIMC_S_DDR0_XPU_CR_ADDR A:0x6044a080
y.create.l HWIO_BIMC_S_DDR0_XPU_PRTN_RACR_SHADOW_ADDR A:0x6044a088
y.create.l HWIO_BIMC_S_DDR0_XPU_PRTN_WACR_SHADOW_ADDR A:0x6044a08c
y.create.l HWIO_BIMC_S_DDR0_XPU_PRTN_START_SHADOW0_ADDR A:0x6044a090
y.create.l HWIO_BIMC_S_DDR0_XPU_PRTN_END_SHADOW0_ADDR A:0x6044a098
y.create.l HWIO_BIMC_S_DDR0_XPU_RPU_ACR0_ADDR A:0x6044a0a0
y.create.l HWIO_BIMC_S_DDR0_XPU_EAR0_ADDR A:0x6044a0c0
y.create.l HWIO_BIMC_S_DDR0_XPU_ESR_ADDR A:0x6044a0c8
y.create.l HWIO_BIMC_S_DDR0_XPU_ESRRESTORE_ADDR A:0x6044a0cc
y.create.l HWIO_BIMC_S_DDR0_XPU_ESYNR0_ADDR A:0x6044a0d0
y.create.l HWIO_BIMC_S_DDR0_XPU_ESYNR1_ADDR A:0x6044a0d4
y.create.l HWIO_BIMC_S_DDR0_XPU_ESYNR2_ADDR A:0x6044a0d8
y.create.l HWIO_BIMC_S_DDR0_XPU_UMR_RACR_ADDR A:0x6044a0e0
y.create.l HWIO_BIMC_S_DDR0_XPU_UMR_WACR_ADDR A:0x6044a0e4
y.create.l HWIO_BIMC_S_DDR0_XPU_UMR_CNTL_ADDR A:0x6044a0f0
y.create.l HWIO_BIMC_S_DDR0_XPU_IDR0_ADDR A:0x6044a074
y.create.l HWIO_BIMC_S_DDR0_XPU_IDR1_ADDR A:0x6044a078
y.create.l HWIO_BIMC_S_DDR0_XPU_REV_ADDR A:0x6044a07c
y.create.l HWIO_BIMC_S_DDR0_XPU_PRT0_RACR0_ADDR A:0x6044a200
y.create.l HWIO_BIMC_S_DDR0_XPU_PRT1_RACR0_ADDR A:0x6044a280
y.create.l HWIO_BIMC_S_DDR0_XPU_PRT2_RACR0_ADDR A:0x6044a300
y.create.l HWIO_BIMC_S_DDR0_XPU_PRT3_RACR0_ADDR A:0x6044a380
y.create.l HWIO_BIMC_S_DDR0_XPU_PRT4_RACR0_ADDR A:0x6044a400
y.create.l HWIO_BIMC_S_DDR0_XPU_PRT5_RACR0_ADDR A:0x6044a480
y.create.l HWIO_BIMC_S_DDR0_XPU_PRT6_RACR0_ADDR A:0x6044a500
y.create.l HWIO_BIMC_S_DDR0_XPU_PRT7_RACR0_ADDR A:0x6044a580
y.create.l HWIO_BIMC_S_DDR0_XPU_PRT8_RACR0_ADDR A:0x6044a600
y.create.l HWIO_BIMC_S_DDR0_XPU_PRT9_RACR0_ADDR A:0x6044a680
y.create.l HWIO_BIMC_S_DDR0_XPU_PRT0_WACR0_ADDR A:0x6044a220
y.create.l HWIO_BIMC_S_DDR0_XPU_PRT1_WACR0_ADDR A:0x6044a2a0
y.create.l HWIO_BIMC_S_DDR0_XPU_PRT2_WACR0_ADDR A:0x6044a320
y.create.l HWIO_BIMC_S_DDR0_XPU_PRT3_WACR0_ADDR A:0x6044a3a0
y.create.l HWIO_BIMC_S_DDR0_XPU_PRT4_WACR0_ADDR A:0x6044a420
y.create.l HWIO_BIMC_S_DDR0_XPU_PRT5_WACR0_ADDR A:0x6044a4a0
y.create.l HWIO_BIMC_S_DDR0_XPU_PRT6_WACR0_ADDR A:0x6044a520
y.create.l HWIO_BIMC_S_DDR0_XPU_PRT7_WACR0_ADDR A:0x6044a5a0
y.create.l HWIO_BIMC_S_DDR0_XPU_PRT8_WACR0_ADDR A:0x6044a620
y.create.l HWIO_BIMC_S_DDR0_XPU_PRT9_WACR0_ADDR A:0x6044a6a0
y.create.l HWIO_BIMC_S_DDR0_XPU_PRT0_START0_ADDR A:0x6044a240
y.create.l HWIO_BIMC_S_DDR0_XPU_PRT1_START0_ADDR A:0x6044a2c0
y.create.l HWIO_BIMC_S_DDR0_XPU_PRT2_START0_ADDR A:0x6044a340
y.create.l HWIO_BIMC_S_DDR0_XPU_PRT3_START0_ADDR A:0x6044a3c0
y.create.l HWIO_BIMC_S_DDR0_XPU_PRT4_START0_ADDR A:0x6044a440
y.create.l HWIO_BIMC_S_DDR0_XPU_PRT5_START0_ADDR A:0x6044a4c0
y.create.l HWIO_BIMC_S_DDR0_XPU_PRT6_START0_ADDR A:0x6044a540
y.create.l HWIO_BIMC_S_DDR0_XPU_PRT7_START0_ADDR A:0x6044a5c0
y.create.l HWIO_BIMC_S_DDR0_XPU_PRT8_START0_ADDR A:0x6044a640
y.create.l HWIO_BIMC_S_DDR0_XPU_PRT9_START0_ADDR A:0x6044a6c0
y.create.l HWIO_BIMC_S_DDR0_XPU_PRT0_END0_ADDR A:0x6044a248
y.create.l HWIO_BIMC_S_DDR0_XPU_PRT1_END0_ADDR A:0x6044a2c8
y.create.l HWIO_BIMC_S_DDR0_XPU_PRT2_END0_ADDR A:0x6044a348
y.create.l HWIO_BIMC_S_DDR0_XPU_PRT3_END0_ADDR A:0x6044a3c8
y.create.l HWIO_BIMC_S_DDR0_XPU_PRT4_END0_ADDR A:0x6044a448
y.create.l HWIO_BIMC_S_DDR0_XPU_PRT5_END0_ADDR A:0x6044a4c8
y.create.l HWIO_BIMC_S_DDR0_XPU_PRT6_END0_ADDR A:0x6044a548
y.create.l HWIO_BIMC_S_DDR0_XPU_PRT7_END0_ADDR A:0x6044a5c8
y.create.l HWIO_BIMC_S_DDR0_XPU_PRT8_END0_ADDR A:0x6044a648
y.create.l HWIO_BIMC_S_DDR0_XPU_PRT9_END0_ADDR A:0x6044a6c8
y.create.l HWIO_BIMC_S_DDR0_XPU_PRT0_SCR_ADDR A:0x6044a250
y.create.l HWIO_BIMC_S_DDR0_XPU_PRT1_SCR_ADDR A:0x6044a2d0
y.create.l HWIO_BIMC_S_DDR0_XPU_PRT2_SCR_ADDR A:0x6044a350
y.create.l HWIO_BIMC_S_DDR0_XPU_PRT3_SCR_ADDR A:0x6044a3d0
y.create.l HWIO_BIMC_S_DDR0_XPU_PRT4_SCR_ADDR A:0x6044a450
y.create.l HWIO_BIMC_S_DDR0_XPU_PRT5_SCR_ADDR A:0x6044a4d0
y.create.l HWIO_BIMC_S_DDR0_XPU_PRT6_SCR_ADDR A:0x6044a550
y.create.l HWIO_BIMC_S_DDR0_XPU_PRT7_SCR_ADDR A:0x6044a5d0
y.create.l HWIO_BIMC_S_DDR0_XPU_PRT8_SCR_ADDR A:0x6044a650
y.create.l HWIO_BIMC_S_DDR0_XPU_PRT9_SCR_ADDR A:0x6044a6d0
y.create.l HWIO_BIMC_S_DDR0_XPU_PRT0_MCR_ADDR A:0x6044a254
y.create.l HWIO_BIMC_S_DDR0_XPU_PRT1_MCR_ADDR A:0x6044a2d4
y.create.l HWIO_BIMC_S_DDR0_XPU_PRT2_MCR_ADDR A:0x6044a354
y.create.l HWIO_BIMC_S_DDR0_XPU_PRT3_MCR_ADDR A:0x6044a3d4
y.create.l HWIO_BIMC_S_DDR0_XPU_PRT4_MCR_ADDR A:0x6044a454
y.create.l HWIO_BIMC_S_DDR0_XPU_PRT5_MCR_ADDR A:0x6044a4d4
y.create.l HWIO_BIMC_S_DDR0_XPU_PRT6_MCR_ADDR A:0x6044a554
y.create.l HWIO_BIMC_S_DDR0_XPU_PRT7_MCR_ADDR A:0x6044a5d4
y.create.l HWIO_BIMC_S_DDR0_XPU_PRT8_MCR_ADDR A:0x6044a654
y.create.l HWIO_BIMC_S_DDR0_XPU_PRT9_MCR_ADDR A:0x6044a6d4
y.create.l HWIO_BIMC_S_DDR0_XPU_PRT0_CNTL0_ADDR A:0x6044a258
y.create.l HWIO_BIMC_S_DDR0_XPU_PRT1_CNTL0_ADDR A:0x6044a2d8
y.create.l HWIO_BIMC_S_DDR0_XPU_PRT2_CNTL0_ADDR A:0x6044a358
y.create.l HWIO_BIMC_S_DDR0_XPU_PRT3_CNTL0_ADDR A:0x6044a3d8
y.create.l HWIO_BIMC_S_DDR0_XPU_PRT4_CNTL0_ADDR A:0x6044a458
y.create.l HWIO_BIMC_S_DDR0_XPU_PRT5_CNTL0_ADDR A:0x6044a4d8
y.create.l HWIO_BIMC_S_DDR0_XPU_PRT6_CNTL0_ADDR A:0x6044a558
y.create.l HWIO_BIMC_S_DDR0_XPU_PRT7_CNTL0_ADDR A:0x6044a5d8
y.create.l HWIO_BIMC_S_DDR0_XPU_PRT8_CNTL0_ADDR A:0x6044a658
y.create.l HWIO_BIMC_S_DDR0_XPU_PRT9_CNTL0_ADDR A:0x6044a6d8
y.create.l HWIO_BIMC_S_DDR0_XPU_PRT0_CNTL1_ADDR A:0x6044a25c
y.create.l HWIO_BIMC_S_DDR0_XPU_PRT1_CNTL1_ADDR A:0x6044a2dc
y.create.l HWIO_BIMC_S_DDR0_XPU_PRT2_CNTL1_ADDR A:0x6044a35c
y.create.l HWIO_BIMC_S_DDR0_XPU_PRT3_CNTL1_ADDR A:0x6044a3dc
y.create.l HWIO_BIMC_S_DDR0_XPU_PRT4_CNTL1_ADDR A:0x6044a45c
y.create.l HWIO_BIMC_S_DDR0_XPU_PRT5_CNTL1_ADDR A:0x6044a4dc
y.create.l HWIO_BIMC_S_DDR0_XPU_PRT6_CNTL1_ADDR A:0x6044a55c
y.create.l HWIO_BIMC_S_DDR0_XPU_PRT7_CNTL1_ADDR A:0x6044a5dc
y.create.l HWIO_BIMC_S_DDR0_XPU_PRT8_CNTL1_ADDR A:0x6044a65c
y.create.l HWIO_BIMC_S_DDR0_XPU_PRT9_CNTL1_ADDR A:0x6044a6dc
y.create.l HWIO_BIMC_S_DDR0_XPU_AMT_RACR_ADDR A:0x6044a0e8
y.create.l HWIO_BIMC_S_DDR0_XPU_AMT_WACR_ADDR A:0x6044a0ec
y.create.l HWIO_BIMC_S_DDR0_XPU_AMTR0_ADDR A:0x6044ae80
y.create.l HWIO_BIMC_S_DDR0_XPU_AMTR1_ADDR A:0x6044ae84
y.create.l HWIO_BIMC_S_DDR0_XPU_AMTR2_ADDR A:0x6044ae88
y.create.l HWIO_BIMC_S_DDR0_XPU_AMTR3_ADDR A:0x6044ae8c
y.create.l HWIO_BIMC_S_DDR0_XPU_AMTR4_ADDR A:0x6044ae90
y.create.l HWIO_BIMC_S_DDR0_XPU_AMTR5_ADDR A:0x6044ae94
y.create.l HWIO_BIMC_S_DDR0_XPU_AMTR6_ADDR A:0x6044ae98
y.create.l HWIO_BIMC_S_DDR0_XPU_AMTR7_ADDR A:0x6044ae9c
y.create.l HWIO_BIMC_S_DDR0_XPU_AMTR8_ADDR A:0x6044aea0
y.create.l HWIO_BIMC_S_DDR0_XPU_AMTR9_ADDR A:0x6044aea4
y.create.l HWIO_BIMC_S_DDR0_DPE_HW_INFO_ADDR A:0x6044c000
y.create.l HWIO_BIMC_S_DDR0_DPE_CONFIG_0_ADDR A:0x6044c010
y.create.l HWIO_BIMC_S_DDR0_DPE_CONFIG_1_ADDR A:0x6044c014
y.create.l HWIO_BIMC_S_DDR0_DPE_CONFIG_2_ADDR A:0x6044c018
y.create.l HWIO_BIMC_S_DDR0_DPE_CONFIG_3_ADDR A:0x6044c01c
y.create.l HWIO_BIMC_S_DDR0_DPE_CONFIG_4_ADDR A:0x6044c020
y.create.l HWIO_BIMC_S_DDR0_DPE_CONFIG_5_ADDR A:0x6044c024
y.create.l HWIO_BIMC_S_DDR0_DPE_CONFIG_6_ADDR A:0x6044c028
y.create.l HWIO_BIMC_S_DDR0_DPE_CONFIG_7_ADDR A:0x6044c02c
y.create.l HWIO_BIMC_S_DDR0_DPE_CONFIG_DQ_MAP_ADDR A:0x6044c038
y.create.l HWIO_BIMC_S_DDR0_DPE_ODT_CONFIG_0_ADDR A:0x6044c040
y.create.l HWIO_BIMC_S_DDR0_DPE_ODT_CONFIG_1_ADDR A:0x6044c044
y.create.l HWIO_BIMC_S_DDR0_DPE_CA_TRAIN_PRE_CS_ADDR A:0x6044c050
y.create.l HWIO_BIMC_S_DDR0_DPE_CA_TRAIN_CS_ADDR A:0x6044c054
y.create.l HWIO_BIMC_S_DDR0_DPE_CA_TRAIN_POST_CS_ADDR A:0x6044c058
y.create.l HWIO_BIMC_S_DDR0_DPE_RCW_CTRL_ADDR A:0x6044c060
y.create.l HWIO_BIMC_S_DDR0_DPE_PWR_CTRL_0_ADDR A:0x6044c068
y.create.l HWIO_BIMC_S_DDR0_DPE_OPT_CTRL_0_ADDR A:0x6044c078
y.create.l HWIO_BIMC_S_DDR0_DPE_OPT_CTRL_1_ADDR A:0x6044c07c
y.create.l HWIO_BIMC_S_DDR0_DPE_DRAM_STATUS_0_ADDR A:0x6044c08c
y.create.l HWIO_BIMC_S_DDR0_DPE_MEMC_STATUS_0_ADDR A:0x6044c09c
y.create.l HWIO_BIMC_S_DDR0_DPE_MEMC_STATUS_1_ADDR A:0x6044c0a0
y.create.l HWIO_BIMC_S_DDR0_DPE_MEMC_STATUS_2_ADDR A:0x6044c0a4
y.create.l HWIO_BIMC_S_DDR0_DPE_INTERRUPT_ENABLE_ADDR A:0x6044c0b4
y.create.l HWIO_BIMC_S_DDR0_DPE_INTERRUPT_STATUS_ADDR A:0x6044c0b8
y.create.l HWIO_BIMC_S_DDR0_DPE_INTERRUPT_CLR_ADDR A:0x6044c0bc
y.create.l HWIO_BIMC_S_DDR0_DPE_INTERRUPT_SET_ADDR A:0x6044c0c0
y.create.l HWIO_BIMC_S_DDR0_DPE_ELEVATE_PRI_RD_ADDR A:0x6044c0d0
y.create.l HWIO_BIMC_S_DDR0_DPE_ELEVATE_PRI_WR_ADDR A:0x6044c0d4
y.create.l HWIO_BIMC_S_DDR0_DPE_TIMER_0_ADDR A:0x6044c0e4
y.create.l HWIO_BIMC_S_DDR0_DPE_TIMER_1_ADDR A:0x6044c0e8
y.create.l HWIO_BIMC_S_DDR0_DPE_TIMER_2_ADDR A:0x6044c0ec
y.create.l HWIO_BIMC_S_DDR0_DPE_TIMER_3_ADDR A:0x6044c0f0
y.create.l HWIO_BIMC_S_DDR0_DPE_MRW_BEFORE_FREQ_SWITCH_0_ADDR A:0x6044c114
y.create.l HWIO_BIMC_S_DDR0_DPE_MRW_BEFORE_FREQ_SWITCH_1_ADDR A:0x6044c118
y.create.l HWIO_BIMC_S_DDR0_DPE_MRW_BEFORE_FREQ_SWITCH_2_ADDR A:0x6044c11c
y.create.l HWIO_BIMC_S_DDR0_DPE_MRW_BEFORE_FREQ_SWITCH_3_ADDR A:0x6044c120
y.create.l HWIO_BIMC_S_DDR0_DPE_MRW_AFTER_FREQ_SWITCH_0_ADDR A:0x6044c124
y.create.l HWIO_BIMC_S_DDR0_DPE_MRW_AFTER_FREQ_SWITCH_1_ADDR A:0x6044c128
y.create.l HWIO_BIMC_S_DDR0_DPE_MRW_AFTER_FREQ_SWITCH_2_ADDR A:0x6044c12c
y.create.l HWIO_BIMC_S_DDR0_DPE_MRW_AFTER_FREQ_SWITCH_3_ADDR A:0x6044c130
y.create.l HWIO_BIMC_S_DDR0_DPE_MRW_FREQ_SWITCH_ADDR A:0x6044c134
y.create.l HWIO_BIMC_S_DDR0_DPE_DRAM_TIMING_0_ADDR A:0x6044c144
y.create.l HWIO_BIMC_S_DDR0_DPE_DRAM_TIMING_1_ADDR A:0x6044c148
y.create.l HWIO_BIMC_S_DDR0_DPE_DRAM_TIMING_2_ADDR A:0x6044c14c
y.create.l HWIO_BIMC_S_DDR0_DPE_DRAM_TIMING_3_ADDR A:0x6044c150
y.create.l HWIO_BIMC_S_DDR0_DPE_DRAM_TIMING_4_ADDR A:0x6044c154
y.create.l HWIO_BIMC_S_DDR0_DPE_DRAM_TIMING_5_ADDR A:0x6044c158
y.create.l HWIO_BIMC_S_DDR0_DPE_DRAM_TIMING_6_ADDR A:0x6044c15c
y.create.l HWIO_BIMC_S_DDR0_DPE_DRAM_TIMING_7_ADDR A:0x6044c160
y.create.l HWIO_BIMC_S_DDR0_DPE_DRAM_TIMING_8_ADDR A:0x6044c164
y.create.l HWIO_BIMC_S_DDR0_DPE_DRAM_TIMING_9_ADDR A:0x6044c168
y.create.l HWIO_BIMC_S_DDR0_DPE_DRAM_TIMING_10_ADDR A:0x6044c16c
y.create.l HWIO_BIMC_S_DDR0_DPE_DRAM_TIMING_11_ADDR A:0x6044c170
y.create.l HWIO_BIMC_S_DDR0_DPE_DRAM_TIMING_12_ADDR A:0x6044c174
y.create.l HWIO_BIMC_S_DDR0_DPE_DRAM_TIMING_13_ADDR A:0x6044c178
y.create.l HWIO_BIMC_S_DDR0_DPE_DRAM_TIMING_14_ADDR A:0x6044c17c
y.create.l HWIO_BIMC_S_DDR0_DPE_DRAM_TIMING_15_ADDR A:0x6044c180
y.create.l HWIO_BIMC_S_DDR0_DPE_DRAM_TIMING_16_ADDR A:0x6044c184
y.create.l HWIO_BIMC_S_DDR0_DPE_DRAM_TIMING_17_ADDR A:0x6044c188
y.create.l HWIO_BIMC_S_DDR0_DPE_DRAM_TIMING_18_ADDR A:0x6044c18c
y.create.l HWIO_BIMC_S_DDR0_DPE_DRAM_TIMING_19_ADDR A:0x6044c190
y.create.l HWIO_BIMC_S_DDR0_DPE_DRAM_TIMING_20_ADDR A:0x6044c194
y.create.l HWIO_BIMC_S_DDR0_DPE_DRAM_TIMING_21_ADDR A:0x6044c198
y.create.l HWIO_BIMC_S_DDR0_DPE_DRAM_TIMING_22_ADDR A:0x6044c19c
y.create.l HWIO_BIMC_S_DDR0_DPE_DRAM_TIMING_23_ADDR A:0x6044c1a0
y.create.l HWIO_BIMC_S_DDR0_DPE_DRAM_TIMING_0_ACT_ADDR A:0x6044c1a4
y.create.l HWIO_BIMC_S_DDR0_DPE_DRAM_TIMING_1_ACT_ADDR A:0x6044c1a8
y.create.l HWIO_BIMC_S_DDR0_DPE_DRAM_TIMING_2_ACT_ADDR A:0x6044c1ac
y.create.l HWIO_BIMC_S_DDR0_DPE_DRAM_TIMING_3_ACT_ADDR A:0x6044c1b0
y.create.l HWIO_BIMC_S_DDR0_DPE_DRAM_TIMING_4_ACT_ADDR A:0x6044c1b4
y.create.l HWIO_BIMC_S_DDR0_DPE_DRAM_TIMING_5_ACT_ADDR A:0x6044c1b8
y.create.l HWIO_BIMC_S_DDR0_DPE_DRAM_TIMING_6_ACT_ADDR A:0x6044c1bc
y.create.l HWIO_BIMC_S_DDR0_DPE_DRAM_TIMING_7_ACT_ADDR A:0x6044c1c0
y.create.l HWIO_BIMC_S_DDR0_DPE_DRAM_TIMING_8_ACT_ADDR A:0x6044c1c4
y.create.l HWIO_BIMC_S_DDR0_DPE_DRAM_TIMING_9_ACT_ADDR A:0x6044c1c8
y.create.l HWIO_BIMC_S_DDR0_DPE_DRAM_TIMING_10_ACT_ADDR A:0x6044c1cc
y.create.l HWIO_BIMC_S_DDR0_DPE_DRAM_TIMING_11_ACT_ADDR A:0x6044c1d0
y.create.l HWIO_BIMC_S_DDR0_DPE_DRAM_TIMING_12_ACT_ADDR A:0x6044c1d4
y.create.l HWIO_BIMC_S_DDR0_DPE_DRAM_TIMING_13_ACT_ADDR A:0x6044c1d8
y.create.l HWIO_BIMC_S_DDR0_DPE_DRAM_TIMING_14_ACT_ADDR A:0x6044c1dc
y.create.l HWIO_BIMC_S_DDR0_DPE_DRAM_TIMING_15_ACT_ADDR A:0x6044c1e0
y.create.l HWIO_BIMC_S_DDR0_DPE_DRAM_TIMING_16_ACT_ADDR A:0x6044c1e4
y.create.l HWIO_BIMC_S_DDR0_DPE_DRAM_TIMING_17_ACT_ADDR A:0x6044c1e8
y.create.l HWIO_BIMC_S_DDR0_DPE_DRAM_TIMING_18_ACT_ADDR A:0x6044c1ec
y.create.l HWIO_BIMC_S_DDR0_DPE_DRAM_TIMING_19_ACT_ADDR A:0x6044c1f0
y.create.l HWIO_BIMC_S_DDR0_DPE_DRAM_TIMING_20_ACT_ADDR A:0x6044c1f4
y.create.l HWIO_BIMC_S_DDR0_DPE_DRAM_TIMING_21_ACT_ADDR A:0x6044c1f8
y.create.l HWIO_BIMC_S_DDR0_DPE_DRAM_TIMING_22_ACT_ADDR A:0x6044c1fc
y.create.l HWIO_BIMC_S_DDR0_DPE_DRAM_TIMING_23_ACT_ADDR A:0x6044c200
y.create.l HWIO_BIMC_S_DDR0_DPE_TESTBUS_CTRL_ADDR A:0x6044c204
y.create.l HWIO_BIMC_S_DDR0_DPE_SPARE_REG_ADDR A:0x6044c214
y.create.l HWIO_BIMC_S_DDR0_DPE_SPARE_REG_ACT_ADDR A:0x6044c224
y.create.l HWIO_BIMC_S_DDR0_DPE_DQCAL_RDATA_RANK1_U_ADDR A:0x6044c240
y.create.l HWIO_BIMC_S_DDR0_DPE_DQCAL_RDATA_RANK1_L_ADDR A:0x6044c244
y.create.l HWIO_BIMC_S_DDR0_DPE_DQCAL_RDATA_RANK0_U_ADDR A:0x6044c248
y.create.l HWIO_BIMC_S_DDR0_DPE_DQCAL_RDATA_RANK0_L_ADDR A:0x6044c24c
y.create.l HWIO_BIMC_S_DDR0_DPE_DQCAL_STATUS0_RANK1_ADDR A:0x6044c260
y.create.l HWIO_BIMC_S_DDR0_DPE_DQCAL_STATUS1_RANK1_ADDR A:0x6044c264
y.create.l HWIO_BIMC_S_DDR0_DPE_DQCAL_STATUS2_RANK1_ADDR A:0x6044c268
y.create.l HWIO_BIMC_S_DDR0_DPE_DQCAL_STATUS0_RANK0_ADDR A:0x6044c280
y.create.l HWIO_BIMC_S_DDR0_DPE_DQCAL_STATUS1_RANK0_ADDR A:0x6044c284
y.create.l HWIO_BIMC_S_DDR0_DPE_DQCAL_STATUS2_RANK0_ADDR A:0x6044c288
y.create.l HWIO_BIMC_S_DDR0_DPE_CGC_CTRL_ADDR A:0x6044c2fc
y.create.l HWIO_BIMC_S_DDR0_DPE_PMON_EN_ADDR A:0x6044c300
y.create.l HWIO_BIMC_S_DDR0_DPE_PMON_CFG_ADDR A:0x6044c304
y.create.l HWIO_BIMC_S_DDR0_DPE_PMON_CMD_QUEUED_0_ADDR A:0x6044c310
y.create.l HWIO_BIMC_S_DDR0_DPE_PMON_CMD_QUEUED_1_ADDR A:0x6044c314
y.create.l HWIO_BIMC_S_DDR0_DPE_PMON_CMD_QUEUED_2_ADDR A:0x6044c318
y.create.l HWIO_BIMC_S_DDR0_DPE_PMON_CMD_QUEUED_3_ADDR A:0x6044c31c
y.create.l HWIO_BIMC_S_DDR0_DPE_PMON_CMD_EXEC_0_ADDR A:0x6044c320
y.create.l HWIO_BIMC_S_DDR0_DPE_PMON_CMD_EXEC_1_ADDR A:0x6044c324
y.create.l HWIO_BIMC_S_DDR0_DPE_PMON_CMD_EXEC_2_ADDR A:0x6044c328
y.create.l HWIO_BIMC_S_DDR0_DPE_PMON_CMD_EXEC_3_ADDR A:0x6044c32c
y.create.l HWIO_BIMC_S_DDR0_DPE_PMON_CMD_FLTR_0_ADDR A:0x6044c330
y.create.l HWIO_BIMC_S_DDR0_DPE_PMON_CMD_FLTR_1_ADDR A:0x6044c334
y.create.l HWIO_BIMC_S_DDR0_DPE_PMON_CMD_FLTR_2_ADDR A:0x6044c338
y.create.l HWIO_BIMC_S_DDR0_DPE_PMON_CMD_FLTR_3_ADDR A:0x6044c33c
y.create.l HWIO_BIMC_S_DDR0_DPE_PMON_ADDR_FLTR_0_ADDR A:0x6044c340
y.create.l HWIO_BIMC_S_DDR0_DPE_PMON_ADDR_FLTR_1_ADDR A:0x6044c344
y.create.l HWIO_BIMC_S_DDR0_DPE_PMON_ADDR_FLTR_2_ADDR A:0x6044c348
y.create.l HWIO_BIMC_S_DDR0_DPE_PMON_ADDR_FLTR_3_ADDR A:0x6044c34c
y.create.l HWIO_BIMC_S_DDR0_DPE_PMON_MID_FLTR_0_ADDR A:0x6044c350
y.create.l HWIO_BIMC_S_DDR0_DPE_PMON_MID_FLTR_1_ADDR A:0x6044c354
y.create.l HWIO_BIMC_S_DDR0_DPE_PMON_LAT_LIM_0_ADDR A:0x6044c360
y.create.l HWIO_BIMC_S_DDR0_DPE_PMON_LAT_LIM_1_ADDR A:0x6044c364
y.create.l HWIO_BIMC_S_DDR0_DPE_PMON_LAT_LIM_2_ADDR A:0x6044c368
y.create.l HWIO_BIMC_S_DDR0_DPE_PMON_LAT_LIM_3_ADDR A:0x6044c36c
y.create.l HWIO_BIMC_S_DDR0_DPE_PMON_PRI_FLTR_0_ADDR A:0x6044c370
y.create.l HWIO_BIMC_S_DDR0_DPE_PMON_PRI_FLTR_1_ADDR A:0x6044c374
y.create.l HWIO_BIMC_S_DDR0_DPE_PMON_PRI_FLTR_2_ADDR A:0x6044c378
y.create.l HWIO_BIMC_S_DDR0_DPE_PMON_PRI_FLTR_3_ADDR A:0x6044c37c
y.create.l HWIO_BIMC_S_DDR0_DPE_PMON_CMDQ_0_ADDR A:0x6044c380
y.create.l HWIO_BIMC_S_DDR0_DPE_PMON_CMDQ_1_ADDR A:0x6044c384
y.create.l HWIO_BIMC_S_DDR0_DPE_PMON_WRBUF_0_ADDR A:0x6044c388
y.create.l HWIO_BIMC_S_DDR0_DPE_PMON_WRBUF_1_ADDR A:0x6044c38c
y.create.l HWIO_BIMC_S_DDR0_DPE_PMON_DDR_CMD_0_ADDR A:0x6044c390
y.create.l HWIO_BIMC_S_DDR0_DPE_PMON_DDR_CMD_1_ADDR A:0x6044c394
y.create.l HWIO_BIMC_S_DDR0_DPE_PMON_DDR_CMD_2_ADDR A:0x6044c398
y.create.l HWIO_BIMC_S_DDR0_DPE_PMON_DDR_CMD_3_ADDR A:0x6044c39c
y.create.l HWIO_BIMC_S_DDR0_DPE_PMON_DDR_DATA_0_ADDR A:0x6044c3a0
y.create.l HWIO_BIMC_S_DDR0_DPE_PMON_DDR_DATA_1_ADDR A:0x6044c3a4
y.create.l HWIO_BIMC_S_DDR0_DPE_PMON_RANK_STATE_0_ADDR A:0x6044c3b0
y.create.l HWIO_BIMC_S_DDR0_DPE_PMON_RANK_STATE_1_ADDR A:0x6044c3b4
y.create.l HWIO_BIMC_S_DDR0_DPE_PMON_RANK_STATE_2_ADDR A:0x6044c3b8
y.create.l HWIO_BIMC_S_DDR0_DPE_PMON_RANK_STATE_3_ADDR A:0x6044c3bc
y.create.l HWIO_BIMC_S_DDR0_DPE_PMON_SHKE_0_ADDR A:0x6044c3c0
y.create.l HWIO_BIMC_S_DDR0_DPE_PMON_SHKE_1_ADDR A:0x6044c3c4
y.create.l HWIO_BIMC_S_DDR0_DPE_PMON_SHKE_2_ADDR A:0x6044c3c8
y.create.l HWIO_BIMC_S_DDR0_DPE_PMON_SHKE_3_ADDR A:0x6044c3cc
y.create.l HWIO_BIMC_S_DDR0_DPE_PMON_SHKE_4_ADDR A:0x6044c3d0
y.create.l HWIO_BIMC_S_DDR0_DPE_PMON_SHKE_5_ADDR A:0x6044c3d4
y.create.l HWIO_BIMC_S_DDR0_DPE_PMON_SHKE_6_ADDR A:0x6044c3d8
y.create.l HWIO_BIMC_S_DDR0_DPE_PMON_SHKE_7_ADDR A:0x6044c3dc
y.create.l HWIO_BIMC_S_DDR0_DPE_DERATE_TEMP_CTRL_ADDR A:0x6044c6e0
y.create.l HWIO_BIMC_S_DDR0_DPE_WR_DATA_CTRL_ADDR A:0x6044c6e4
y.create.l HWIO_BIMC_S_DDR0_SHKE_HW_INFO_ADDR A:0x6044d000
y.create.l HWIO_BIMC_S_DDR0_SHKE_CONFIG_ADDR A:0x6044d004
y.create.l HWIO_BIMC_S_DDR0_SHKE_CGC_CNTL_ADDR A:0x6044d010
y.create.l HWIO_BIMC_S_DDR0_SHKE_DRAM_MANUAL_0_ADDR A:0x6044d020
y.create.l HWIO_BIMC_S_DDR0_SHKE_DRAM_MANUAL_1_ADDR A:0x6044d024
y.create.l HWIO_BIMC_S_DDR0_SHKE_MREG_ADDR_WDATA_CNTL_ADDR A:0x6044d030
y.create.l HWIO_BIMC_S_DDR0_SHKE_MREG_RDATA_RANK1_U_ADDR A:0x6044d050
y.create.l HWIO_BIMC_S_DDR0_SHKE_MREG_RDATA_RANK1_L_ADDR A:0x6044d054
y.create.l HWIO_BIMC_S_DDR0_SHKE_MREG_RDATA_RANK0_U_ADDR A:0x6044d060
y.create.l HWIO_BIMC_S_DDR0_SHKE_MREG_RDATA_RANK0_L_ADDR A:0x6044d064
y.create.l HWIO_BIMC_S_DDR0_SHKE_MREG_RDATA_STATUS_ADDR A:0x6044d070
y.create.l HWIO_BIMC_S_DDR0_SHKE_DRAM_STATUS_ADDR A:0x6044d074
y.create.l HWIO_BIMC_S_DDR0_SHKE_DRAM_DEBUG_CMD_0_ADDR A:0x6044d080
y.create.l HWIO_BIMC_S_DDR0_SHKE_DRAM_DEBUG_CMD_1_ADDR A:0x6044d084
y.create.l HWIO_BIMC_S_DDR0_SHKE_DRAM_DEBUG_CMD_2_ADDR A:0x6044d088
y.create.l HWIO_BIMC_S_DDR0_SHKE_PERIODIC_MRR_ADDR A:0x6044d0a0
y.create.l HWIO_BIMC_S_DDR0_SHKE_PERIODIC_MRR_RDATA_RANK1_U_ADDR A:0x6044d0b0
y.create.l HWIO_BIMC_S_DDR0_SHKE_PERIODIC_MRR_RDATA_RANK1_L_ADDR A:0x6044d0b4
y.create.l HWIO_BIMC_S_DDR0_SHKE_PERIODIC_MRR_RDATA_RANK0_U_ADDR A:0x6044d0b8
y.create.l HWIO_BIMC_S_DDR0_SHKE_PERIODIC_MRR_RDATA_RANK0_L_ADDR A:0x6044d0bc
y.create.l HWIO_BIMC_S_DDR0_SHKE_PERIODIC_ZQCAL_ADDR A:0x6044d0d0
y.create.l HWIO_BIMC_S_DDR0_SHKE_AUTO_REFRESH_CNTL_ADDR A:0x6044d0f0
y.create.l HWIO_BIMC_S_DDR0_SHKE_SELF_REFRESH_CNTL_ADDR A:0x6044d0f4
y.create.l HWIO_BIMC_S_DDR0_SHKE_AUTO_REFRESH_CNTL_1_ADDR A:0x6044d100
y.create.l HWIO_BIMC_S_DDR0_SHKE_AUTO_REFRESH_CNTL_2_ADDR A:0x6044d104
y.create.l HWIO_BIMC_S_DDR0_SHKE_TESTBUS_CNTL_ADDR A:0x6044d114
y.create.l HWIO_BIMC_S_DDR0_SHKE_SPARE_REG_ADDR A:0x6044d130
y.create.l HWIO_BIMC_S_DDR0_SHKE_DERATE_REF_RANK0_ADDR A:0x6044d0c0
y.create.l HWIO_BIMC_S_DDR0_SHKE_DERATE_REF_RANK1_ADDR A:0x6044d0c4
y.create.l HWIO_BIMC_MPU_XPU_SCR_ADDR A:0x60032000
y.create.l HWIO_BIMC_MPU_XPU_SWDR_ADDR A:0x60032004
y.create.l HWIO_BIMC_MPU_XPU_PRTN_RACR_SSHADOW_ADDR A:0x60032008
y.create.l HWIO_BIMC_MPU_XPU_PRTN_START_SSHADOW0_ADDR A:0x60032010
y.create.l HWIO_BIMC_MPU_XPU_PRTN_END_SSHADOW0_ADDR A:0x60032018
y.create.l HWIO_BIMC_MPU_XPU_SEAR0_ADDR A:0x60032040
y.create.l HWIO_BIMC_MPU_XPU_SESR_ADDR A:0x60032048
y.create.l HWIO_BIMC_MPU_XPU_SESRRESTORE_ADDR A:0x6003204c
y.create.l HWIO_BIMC_MPU_XPU_SESYNR0_ADDR A:0x60032050
y.create.l HWIO_BIMC_MPU_XPU_SESYNR1_ADDR A:0x60032054
y.create.l HWIO_BIMC_MPU_XPU_SESYNR2_ADDR A:0x60032058
y.create.l HWIO_BIMC_MPU_XPU_MCR_ADDR A:0x60032100
y.create.l HWIO_BIMC_MPU_XPU_MEAR0_ADDR A:0x60032140
y.create.l HWIO_BIMC_MPU_XPU_MESR_ADDR A:0x60032148
y.create.l HWIO_BIMC_MPU_XPU_MESRRESTORE_ADDR A:0x6003214c
y.create.l HWIO_BIMC_MPU_XPU_MESYNR0_ADDR A:0x60032150
y.create.l HWIO_BIMC_MPU_XPU_MESYNR1_ADDR A:0x60032154
y.create.l HWIO_BIMC_MPU_XPU_MESYNR2_ADDR A:0x60032158
y.create.l HWIO_BIMC_MPU_XPU_CR_ADDR A:0x60032080
y.create.l HWIO_BIMC_MPU_XPU_PRTN_RACR_SHADOW_ADDR A:0x60032088
y.create.l HWIO_BIMC_MPU_XPU_PRTN_START_SHADOW0_ADDR A:0x60032090
y.create.l HWIO_BIMC_MPU_XPU_PRTN_END_SHADOW0_ADDR A:0x60032098
y.create.l HWIO_BIMC_MPU_XPU_RPU_ACR0_ADDR A:0x600320a0
y.create.l HWIO_BIMC_MPU_XPU_EAR0_ADDR A:0x600320c0
y.create.l HWIO_BIMC_MPU_XPU_ESR_ADDR A:0x600320c8
y.create.l HWIO_BIMC_MPU_XPU_ESRRESTORE_ADDR A:0x600320cc
y.create.l HWIO_BIMC_MPU_XPU_ESYNR0_ADDR A:0x600320d0
y.create.l HWIO_BIMC_MPU_XPU_ESYNR1_ADDR A:0x600320d4
y.create.l HWIO_BIMC_MPU_XPU_ESYNR2_ADDR A:0x600320d8
y.create.l HWIO_BIMC_MPU_XPU_UMR_RACR_ADDR A:0x600320e0
y.create.l HWIO_BIMC_MPU_XPU_UMR_WACR_ADDR A:0x600320e4
y.create.l HWIO_BIMC_MPU_XPU_UMR_CNTL_ADDR A:0x600320f0
y.create.l HWIO_BIMC_MPU_XPU_IDR0_ADDR A:0x60032074
y.create.l HWIO_BIMC_MPU_XPU_IDR1_ADDR A:0x60032078
y.create.l HWIO_BIMC_MPU_XPU_REV_ADDR A:0x6003207c
y.create.l HWIO_BIMC_MPU_XPU_PRT0_RACR0_ADDR A:0x60032200
y.create.l HWIO_BIMC_MPU_XPU_PRT1_RACR0_ADDR A:0x60032280
y.create.l HWIO_BIMC_MPU_XPU_PRT2_RACR0_ADDR A:0x60032300
y.create.l HWIO_BIMC_MPU_XPU_PRT3_RACR0_ADDR A:0x60032380
y.create.l HWIO_BIMC_MPU_XPU_PRT4_RACR0_ADDR A:0x60032400
y.create.l HWIO_BIMC_MPU_XPU_PRT5_RACR0_ADDR A:0x60032480
y.create.l HWIO_BIMC_MPU_XPU_PRT6_RACR0_ADDR A:0x60032500
y.create.l HWIO_BIMC_MPU_XPU_PRT7_RACR0_ADDR A:0x60032580
y.create.l HWIO_BIMC_MPU_XPU_PRT8_RACR0_ADDR A:0x60032600
y.create.l HWIO_BIMC_MPU_XPU_PRT9_RACR0_ADDR A:0x60032680
y.create.l HWIO_BIMC_MPU_XPU_PRT0_START0_ADDR A:0x60032240
y.create.l HWIO_BIMC_MPU_XPU_PRT1_START0_ADDR A:0x600322c0
y.create.l HWIO_BIMC_MPU_XPU_PRT2_START0_ADDR A:0x60032340
y.create.l HWIO_BIMC_MPU_XPU_PRT3_START0_ADDR A:0x600323c0
y.create.l HWIO_BIMC_MPU_XPU_PRT4_START0_ADDR A:0x60032440
y.create.l HWIO_BIMC_MPU_XPU_PRT5_START0_ADDR A:0x600324c0
y.create.l HWIO_BIMC_MPU_XPU_PRT6_START0_ADDR A:0x60032540
y.create.l HWIO_BIMC_MPU_XPU_PRT7_START0_ADDR A:0x600325c0
y.create.l HWIO_BIMC_MPU_XPU_PRT8_START0_ADDR A:0x60032640
y.create.l HWIO_BIMC_MPU_XPU_PRT9_START0_ADDR A:0x600326c0
y.create.l HWIO_BIMC_MPU_XPU_PRT0_END0_ADDR A:0x60032248
y.create.l HWIO_BIMC_MPU_XPU_PRT1_END0_ADDR A:0x600322c8
y.create.l HWIO_BIMC_MPU_XPU_PRT2_END0_ADDR A:0x60032348
y.create.l HWIO_BIMC_MPU_XPU_PRT3_END0_ADDR A:0x600323c8
y.create.l HWIO_BIMC_MPU_XPU_PRT4_END0_ADDR A:0x60032448
y.create.l HWIO_BIMC_MPU_XPU_PRT5_END0_ADDR A:0x600324c8
y.create.l HWIO_BIMC_MPU_XPU_PRT6_END0_ADDR A:0x60032548
y.create.l HWIO_BIMC_MPU_XPU_PRT7_END0_ADDR A:0x600325c8
y.create.l HWIO_BIMC_MPU_XPU_PRT8_END0_ADDR A:0x60032648
y.create.l HWIO_BIMC_MPU_XPU_PRT9_END0_ADDR A:0x600326c8
y.create.l HWIO_BIMC_MPU_XPU_PRT0_SCR_ADDR A:0x60032250
y.create.l HWIO_BIMC_MPU_XPU_PRT1_SCR_ADDR A:0x600322d0
y.create.l HWIO_BIMC_MPU_XPU_PRT2_SCR_ADDR A:0x60032350
y.create.l HWIO_BIMC_MPU_XPU_PRT3_SCR_ADDR A:0x600323d0
y.create.l HWIO_BIMC_MPU_XPU_PRT4_SCR_ADDR A:0x60032450
y.create.l HWIO_BIMC_MPU_XPU_PRT5_SCR_ADDR A:0x600324d0
y.create.l HWIO_BIMC_MPU_XPU_PRT6_SCR_ADDR A:0x60032550
y.create.l HWIO_BIMC_MPU_XPU_PRT7_SCR_ADDR A:0x600325d0
y.create.l HWIO_BIMC_MPU_XPU_PRT8_SCR_ADDR A:0x60032650
y.create.l HWIO_BIMC_MPU_XPU_PRT9_SCR_ADDR A:0x600326d0
y.create.l HWIO_BIMC_MPU_XPU_PRT0_MCR_ADDR A:0x60032254
y.create.l HWIO_BIMC_MPU_XPU_PRT1_MCR_ADDR A:0x600322d4
y.create.l HWIO_BIMC_MPU_XPU_PRT2_MCR_ADDR A:0x60032354
y.create.l HWIO_BIMC_MPU_XPU_PRT3_MCR_ADDR A:0x600323d4
y.create.l HWIO_BIMC_MPU_XPU_PRT4_MCR_ADDR A:0x60032454
y.create.l HWIO_BIMC_MPU_XPU_PRT5_MCR_ADDR A:0x600324d4
y.create.l HWIO_BIMC_MPU_XPU_PRT6_MCR_ADDR A:0x60032554
y.create.l HWIO_BIMC_MPU_XPU_PRT7_MCR_ADDR A:0x600325d4
y.create.l HWIO_BIMC_MPU_XPU_PRT8_MCR_ADDR A:0x60032654
y.create.l HWIO_BIMC_MPU_XPU_PRT9_MCR_ADDR A:0x600326d4
y.create.l HWIO_BIMC_MPU_XPU_PRT0_CNTL0_ADDR A:0x60032258
y.create.l HWIO_BIMC_MPU_XPU_PRT1_CNTL0_ADDR A:0x600322d8
y.create.l HWIO_BIMC_MPU_XPU_PRT2_CNTL0_ADDR A:0x60032358
y.create.l HWIO_BIMC_MPU_XPU_PRT3_CNTL0_ADDR A:0x600323d8
y.create.l HWIO_BIMC_MPU_XPU_PRT4_CNTL0_ADDR A:0x60032458
y.create.l HWIO_BIMC_MPU_XPU_PRT5_CNTL0_ADDR A:0x600324d8
y.create.l HWIO_BIMC_MPU_XPU_PRT6_CNTL0_ADDR A:0x60032558
y.create.l HWIO_BIMC_MPU_XPU_PRT7_CNTL0_ADDR A:0x600325d8
y.create.l HWIO_BIMC_MPU_XPU_PRT8_CNTL0_ADDR A:0x60032658
y.create.l HWIO_BIMC_MPU_XPU_PRT9_CNTL0_ADDR A:0x600326d8
y.create.l HWIO_BIMC_MPU_XPU_PRT0_CNTL1_ADDR A:0x6003225c
y.create.l HWIO_BIMC_MPU_XPU_PRT1_CNTL1_ADDR A:0x600322dc
y.create.l HWIO_BIMC_MPU_XPU_PRT2_CNTL1_ADDR A:0x6003235c
y.create.l HWIO_BIMC_MPU_XPU_PRT3_CNTL1_ADDR A:0x600323dc
y.create.l HWIO_BIMC_MPU_XPU_PRT4_CNTL1_ADDR A:0x6003245c
y.create.l HWIO_BIMC_MPU_XPU_PRT5_CNTL1_ADDR A:0x600324dc
y.create.l HWIO_BIMC_MPU_XPU_PRT6_CNTL1_ADDR A:0x6003255c
y.create.l HWIO_BIMC_MPU_XPU_PRT7_CNTL1_ADDR A:0x600325dc
y.create.l HWIO_BIMC_MPU_XPU_PRT8_CNTL1_ADDR A:0x6003265c
y.create.l HWIO_BIMC_MPU_XPU_PRT9_CNTL1_ADDR A:0x600326dc
y.create.l HWIO_BLSP1_BLSP_BAM_BAM_CTRL_ADDR A:0x67884000
y.create.l HWIO_BLSP1_BLSP_BAM_BAM_TIMER_ADDR A:0x67884040
y.create.l HWIO_BLSP1_BLSP_BAM_BAM_TIMER_CTRL_ADDR A:0x67884044
y.create.l HWIO_BLSP1_BLSP_BAM_BAM_DESC_CNT_TRSHLD_ADDR A:0x67884008
y.create.l HWIO_BLSP1_BLSP_BAM_BAM_IRQ_STTS_ADDR A:0x67884014
y.create.l HWIO_BLSP1_BLSP_BAM_BAM_IRQ_CLR_ADDR A:0x67884018
y.create.l HWIO_BLSP1_BLSP_BAM_BAM_IRQ_EN_ADDR A:0x6788401c
y.create.l HWIO_BLSP1_BLSP_BAM_BAM_CNFG_BITS_ADDR A:0x6788407c
y.create.l HWIO_BLSP1_BLSP_BAM_BAM_REVISION_ADDR A:0x67885000
y.create.l HWIO_BLSP1_BLSP_BAM_BAM_SW_VERSION_ADDR A:0x67885004
y.create.l HWIO_BLSP1_BLSP_BAM_BAM_NUM_PIPES_ADDR A:0x67885008
y.create.l HWIO_BLSP1_BLSP_BAM_BAM_TEST_BUS_SEL_ADDR A:0x67885010
y.create.l HWIO_BLSP1_BLSP_BAM_BAM_TEST_BUS_REG_ADDR A:0x67885014
y.create.l HWIO_BLSP1_BLSP_BAM_BAM_AHB_MASTER_ERR_CTRLS_ADDR A:0x67885024
y.create.l HWIO_BLSP1_BLSP_BAM_BAM_AHB_MASTER_ERR_ADDR_ADDR A:0x67885028
y.create.l HWIO_BLSP1_BLSP_BAM_BAM_AHB_MASTER_ERR_DATA_ADDR A:0x6788502c
y.create.l HWIO_BLSP1_BLSP_BAM_BAM_AHB_MASTER_ERR_ADDR_LSB_ADDR A:0x67885100
y.create.l HWIO_BLSP1_BLSP_BAM_BAM_AHB_MASTER_ERR_ADDR_MSB_ADDR A:0x67885104
y.create.l HWIO_BLSP1_BLSP_BAM_BAM_TRUST_REG_ADDR A:0x67886000
y.create.l HWIO_BLSP1_BLSP_BAM_BAM_P_TRUST_REG0_ADDR A:0x67886020
y.create.l HWIO_BLSP1_BLSP_BAM_BAM_P_TRUST_REG1_ADDR A:0x67886024
y.create.l HWIO_BLSP1_BLSP_BAM_BAM_P_TRUST_REG2_ADDR A:0x67886028
y.create.l HWIO_BLSP1_BLSP_BAM_BAM_P_TRUST_REG3_ADDR A:0x6788602c
y.create.l HWIO_BLSP1_BLSP_BAM_BAM_P_TRUST_REG4_ADDR A:0x67886030
y.create.l HWIO_BLSP1_BLSP_BAM_BAM_P_TRUST_REG5_ADDR A:0x67886034
y.create.l HWIO_BLSP1_BLSP_BAM_BAM_P_TRUST_REG6_ADDR A:0x67886038
y.create.l HWIO_BLSP1_BLSP_BAM_BAM_P_TRUST_REG7_ADDR A:0x6788603c
y.create.l HWIO_BLSP1_BLSP_BAM_BAM_P_TRUST_REG8_ADDR A:0x67886040
y.create.l HWIO_BLSP1_BLSP_BAM_BAM_P_TRUST_REG9_ADDR A:0x67886044
y.create.l HWIO_BLSP1_BLSP_BAM_BAM_IRQ_SRCS_EE0_ADDR A:0x67887000
y.create.l HWIO_BLSP1_BLSP_BAM_BAM_IRQ_SRCS_EE1_ADDR A:0x67888000
y.create.l HWIO_BLSP1_BLSP_BAM_BAM_IRQ_SRCS_EE2_ADDR A:0x67889000
y.create.l HWIO_BLSP1_BLSP_BAM_BAM_IRQ_SRCS_EE3_ADDR A:0x6788a000
y.create.l HWIO_BLSP1_BLSP_BAM_BAM_IRQ_SRCS_EE4_ADDR A:0x6788b000
y.create.l HWIO_BLSP1_BLSP_BAM_BAM_IRQ_SRCS_EE5_ADDR A:0x6788c000
y.create.l HWIO_BLSP1_BLSP_BAM_BAM_IRQ_SRCS_EE6_ADDR A:0x6788d000
y.create.l HWIO_BLSP1_BLSP_BAM_BAM_IRQ_SRCS_EE7_ADDR A:0x6788e000
y.create.l HWIO_BLSP1_BLSP_BAM_BAM_IRQ_SRCS_MSK_EE0_ADDR A:0x67887004
y.create.l HWIO_BLSP1_BLSP_BAM_BAM_IRQ_SRCS_MSK_EE1_ADDR A:0x67888004
y.create.l HWIO_BLSP1_BLSP_BAM_BAM_IRQ_SRCS_MSK_EE2_ADDR A:0x67889004
y.create.l HWIO_BLSP1_BLSP_BAM_BAM_IRQ_SRCS_MSK_EE3_ADDR A:0x6788a004
y.create.l HWIO_BLSP1_BLSP_BAM_BAM_IRQ_SRCS_MSK_EE4_ADDR A:0x6788b004
y.create.l HWIO_BLSP1_BLSP_BAM_BAM_IRQ_SRCS_MSK_EE5_ADDR A:0x6788c004
y.create.l HWIO_BLSP1_BLSP_BAM_BAM_IRQ_SRCS_MSK_EE6_ADDR A:0x6788d004
y.create.l HWIO_BLSP1_BLSP_BAM_BAM_IRQ_SRCS_MSK_EE7_ADDR A:0x6788e004
y.create.l HWIO_BLSP1_BLSP_BAM_BAM_IRQ_SRCS_UNMASKED_EE0_ADDR A:0x67887008
y.create.l HWIO_BLSP1_BLSP_BAM_BAM_IRQ_SRCS_UNMASKED_EE1_ADDR A:0x67888008
y.create.l HWIO_BLSP1_BLSP_BAM_BAM_IRQ_SRCS_UNMASKED_EE2_ADDR A:0x67889008
y.create.l HWIO_BLSP1_BLSP_BAM_BAM_IRQ_SRCS_UNMASKED_EE3_ADDR A:0x6788a008
y.create.l HWIO_BLSP1_BLSP_BAM_BAM_IRQ_SRCS_UNMASKED_EE4_ADDR A:0x6788b008
y.create.l HWIO_BLSP1_BLSP_BAM_BAM_IRQ_SRCS_UNMASKED_EE5_ADDR A:0x6788c008
y.create.l HWIO_BLSP1_BLSP_BAM_BAM_IRQ_SRCS_UNMASKED_EE6_ADDR A:0x6788d008
y.create.l HWIO_BLSP1_BLSP_BAM_BAM_IRQ_SRCS_UNMASKED_EE7_ADDR A:0x6788e008
y.create.l HWIO_BLSP1_BLSP_BAM_BAM_PIPE_ATTR_EE0_ADDR A:0x6788700c
y.create.l HWIO_BLSP1_BLSP_BAM_BAM_PIPE_ATTR_EE1_ADDR A:0x6788800c
y.create.l HWIO_BLSP1_BLSP_BAM_BAM_PIPE_ATTR_EE2_ADDR A:0x6788900c
y.create.l HWIO_BLSP1_BLSP_BAM_BAM_PIPE_ATTR_EE3_ADDR A:0x6788a00c
y.create.l HWIO_BLSP1_BLSP_BAM_BAM_PIPE_ATTR_EE4_ADDR A:0x6788b00c
y.create.l HWIO_BLSP1_BLSP_BAM_BAM_PIPE_ATTR_EE5_ADDR A:0x6788c00c
y.create.l HWIO_BLSP1_BLSP_BAM_BAM_PIPE_ATTR_EE6_ADDR A:0x6788d00c
y.create.l HWIO_BLSP1_BLSP_BAM_BAM_PIPE_ATTR_EE7_ADDR A:0x6788e00c
y.create.l HWIO_BLSP1_BLSP_BAM_BAM_IRQ_SRCS_ADDR A:0x67887010
y.create.l HWIO_BLSP1_BLSP_BAM_BAM_IRQ_SRCS_MSK_ADDR A:0x67887014
y.create.l HWIO_BLSP1_BLSP_BAM_BAM_IRQ_SRCS_UNMASKED_ADDR A:0x67887018
y.create.l HWIO_BLSP1_BLSP_BAM_BAM_P_CTRL0_ADDR A:0x67897000
y.create.l HWIO_BLSP1_BLSP_BAM_BAM_P_CTRL1_ADDR A:0x67898000
y.create.l HWIO_BLSP1_BLSP_BAM_BAM_P_CTRL2_ADDR A:0x67899000
y.create.l HWIO_BLSP1_BLSP_BAM_BAM_P_CTRL3_ADDR A:0x6789a000
y.create.l HWIO_BLSP1_BLSP_BAM_BAM_P_CTRL4_ADDR A:0x6789b000
y.create.l HWIO_BLSP1_BLSP_BAM_BAM_P_CTRL5_ADDR A:0x6789c000
y.create.l HWIO_BLSP1_BLSP_BAM_BAM_P_CTRL6_ADDR A:0x6789d000
y.create.l HWIO_BLSP1_BLSP_BAM_BAM_P_CTRL7_ADDR A:0x6789e000
y.create.l HWIO_BLSP1_BLSP_BAM_BAM_P_CTRL8_ADDR A:0x6789f000
y.create.l HWIO_BLSP1_BLSP_BAM_BAM_P_CTRL9_ADDR A:0x678a0000
y.create.l HWIO_BLSP1_BLSP_BAM_BAM_P_RST0_ADDR A:0x67897004
y.create.l HWIO_BLSP1_BLSP_BAM_BAM_P_RST1_ADDR A:0x67898004
y.create.l HWIO_BLSP1_BLSP_BAM_BAM_P_RST2_ADDR A:0x67899004
y.create.l HWIO_BLSP1_BLSP_BAM_BAM_P_RST3_ADDR A:0x6789a004
y.create.l HWIO_BLSP1_BLSP_BAM_BAM_P_RST4_ADDR A:0x6789b004
y.create.l HWIO_BLSP1_BLSP_BAM_BAM_P_RST5_ADDR A:0x6789c004
y.create.l HWIO_BLSP1_BLSP_BAM_BAM_P_RST6_ADDR A:0x6789d004
y.create.l HWIO_BLSP1_BLSP_BAM_BAM_P_RST7_ADDR A:0x6789e004
y.create.l HWIO_BLSP1_BLSP_BAM_BAM_P_RST8_ADDR A:0x6789f004
y.create.l HWIO_BLSP1_BLSP_BAM_BAM_P_RST9_ADDR A:0x678a0004
y.create.l HWIO_BLSP1_BLSP_BAM_BAM_P_HALT0_ADDR A:0x67897008
y.create.l HWIO_BLSP1_BLSP_BAM_BAM_P_HALT1_ADDR A:0x67898008
y.create.l HWIO_BLSP1_BLSP_BAM_BAM_P_HALT2_ADDR A:0x67899008
y.create.l HWIO_BLSP1_BLSP_BAM_BAM_P_HALT3_ADDR A:0x6789a008
y.create.l HWIO_BLSP1_BLSP_BAM_BAM_P_HALT4_ADDR A:0x6789b008
y.create.l HWIO_BLSP1_BLSP_BAM_BAM_P_HALT5_ADDR A:0x6789c008
y.create.l HWIO_BLSP1_BLSP_BAM_BAM_P_HALT6_ADDR A:0x6789d008
y.create.l HWIO_BLSP1_BLSP_BAM_BAM_P_HALT7_ADDR A:0x6789e008
y.create.l HWIO_BLSP1_BLSP_BAM_BAM_P_HALT8_ADDR A:0x6789f008
y.create.l HWIO_BLSP1_BLSP_BAM_BAM_P_HALT9_ADDR A:0x678a0008
y.create.l HWIO_BLSP1_BLSP_BAM_BAM_P_IRQ_STTS0_ADDR A:0x67897010
y.create.l HWIO_BLSP1_BLSP_BAM_BAM_P_IRQ_STTS1_ADDR A:0x67898010
y.create.l HWIO_BLSP1_BLSP_BAM_BAM_P_IRQ_STTS2_ADDR A:0x67899010
y.create.l HWIO_BLSP1_BLSP_BAM_BAM_P_IRQ_STTS3_ADDR A:0x6789a010
y.create.l HWIO_BLSP1_BLSP_BAM_BAM_P_IRQ_STTS4_ADDR A:0x6789b010
y.create.l HWIO_BLSP1_BLSP_BAM_BAM_P_IRQ_STTS5_ADDR A:0x6789c010
y.create.l HWIO_BLSP1_BLSP_BAM_BAM_P_IRQ_STTS6_ADDR A:0x6789d010
y.create.l HWIO_BLSP1_BLSP_BAM_BAM_P_IRQ_STTS7_ADDR A:0x6789e010
y.create.l HWIO_BLSP1_BLSP_BAM_BAM_P_IRQ_STTS8_ADDR A:0x6789f010
y.create.l HWIO_BLSP1_BLSP_BAM_BAM_P_IRQ_STTS9_ADDR A:0x678a0010
y.create.l HWIO_BLSP1_BLSP_BAM_BAM_P_IRQ_CLR0_ADDR A:0x67897014
y.create.l HWIO_BLSP1_BLSP_BAM_BAM_P_IRQ_CLR1_ADDR A:0x67898014
y.create.l HWIO_BLSP1_BLSP_BAM_BAM_P_IRQ_CLR2_ADDR A:0x67899014
y.create.l HWIO_BLSP1_BLSP_BAM_BAM_P_IRQ_CLR3_ADDR A:0x6789a014
y.create.l HWIO_BLSP1_BLSP_BAM_BAM_P_IRQ_CLR4_ADDR A:0x6789b014
y.create.l HWIO_BLSP1_BLSP_BAM_BAM_P_IRQ_CLR5_ADDR A:0x6789c014
y.create.l HWIO_BLSP1_BLSP_BAM_BAM_P_IRQ_CLR6_ADDR A:0x6789d014
y.create.l HWIO_BLSP1_BLSP_BAM_BAM_P_IRQ_CLR7_ADDR A:0x6789e014
y.create.l HWIO_BLSP1_BLSP_BAM_BAM_P_IRQ_CLR8_ADDR A:0x6789f014
y.create.l HWIO_BLSP1_BLSP_BAM_BAM_P_IRQ_CLR9_ADDR A:0x678a0014
y.create.l HWIO_BLSP1_BLSP_BAM_BAM_P_IRQ_EN0_ADDR A:0x67897018
y.create.l HWIO_BLSP1_BLSP_BAM_BAM_P_IRQ_EN1_ADDR A:0x67898018
y.create.l HWIO_BLSP1_BLSP_BAM_BAM_P_IRQ_EN2_ADDR A:0x67899018
y.create.l HWIO_BLSP1_BLSP_BAM_BAM_P_IRQ_EN3_ADDR A:0x6789a018
y.create.l HWIO_BLSP1_BLSP_BAM_BAM_P_IRQ_EN4_ADDR A:0x6789b018
y.create.l HWIO_BLSP1_BLSP_BAM_BAM_P_IRQ_EN5_ADDR A:0x6789c018
y.create.l HWIO_BLSP1_BLSP_BAM_BAM_P_IRQ_EN6_ADDR A:0x6789d018
y.create.l HWIO_BLSP1_BLSP_BAM_BAM_P_IRQ_EN7_ADDR A:0x6789e018
y.create.l HWIO_BLSP1_BLSP_BAM_BAM_P_IRQ_EN8_ADDR A:0x6789f018
y.create.l HWIO_BLSP1_BLSP_BAM_BAM_P_IRQ_EN9_ADDR A:0x678a0018
y.create.l HWIO_BLSP1_BLSP_BAM_BAM_P_TIMER0_ADDR A:0x6789701c
y.create.l HWIO_BLSP1_BLSP_BAM_BAM_P_TIMER1_ADDR A:0x6789801c
y.create.l HWIO_BLSP1_BLSP_BAM_BAM_P_TIMER2_ADDR A:0x6789901c
y.create.l HWIO_BLSP1_BLSP_BAM_BAM_P_TIMER3_ADDR A:0x6789a01c
y.create.l HWIO_BLSP1_BLSP_BAM_BAM_P_TIMER4_ADDR A:0x6789b01c
y.create.l HWIO_BLSP1_BLSP_BAM_BAM_P_TIMER5_ADDR A:0x6789c01c
y.create.l HWIO_BLSP1_BLSP_BAM_BAM_P_TIMER6_ADDR A:0x6789d01c
y.create.l HWIO_BLSP1_BLSP_BAM_BAM_P_TIMER7_ADDR A:0x6789e01c
y.create.l HWIO_BLSP1_BLSP_BAM_BAM_P_TIMER8_ADDR A:0x6789f01c
y.create.l HWIO_BLSP1_BLSP_BAM_BAM_P_TIMER9_ADDR A:0x678a001c
y.create.l HWIO_BLSP1_BLSP_BAM_BAM_P_TIMER_CTRL0_ADDR A:0x67897020
y.create.l HWIO_BLSP1_BLSP_BAM_BAM_P_TIMER_CTRL1_ADDR A:0x67898020
y.create.l HWIO_BLSP1_BLSP_BAM_BAM_P_TIMER_CTRL2_ADDR A:0x67899020
y.create.l HWIO_BLSP1_BLSP_BAM_BAM_P_TIMER_CTRL3_ADDR A:0x6789a020
y.create.l HWIO_BLSP1_BLSP_BAM_BAM_P_TIMER_CTRL4_ADDR A:0x6789b020
y.create.l HWIO_BLSP1_BLSP_BAM_BAM_P_TIMER_CTRL5_ADDR A:0x6789c020
y.create.l HWIO_BLSP1_BLSP_BAM_BAM_P_TIMER_CTRL6_ADDR A:0x6789d020
y.create.l HWIO_BLSP1_BLSP_BAM_BAM_P_TIMER_CTRL7_ADDR A:0x6789e020
y.create.l HWIO_BLSP1_BLSP_BAM_BAM_P_TIMER_CTRL8_ADDR A:0x6789f020
y.create.l HWIO_BLSP1_BLSP_BAM_BAM_P_TIMER_CTRL9_ADDR A:0x678a0020
y.create.l HWIO_BLSP1_BLSP_BAM_BAM_P_PRDCR_SDBND0_ADDR A:0x67897024
y.create.l HWIO_BLSP1_BLSP_BAM_BAM_P_PRDCR_SDBND1_ADDR A:0x67898024
y.create.l HWIO_BLSP1_BLSP_BAM_BAM_P_PRDCR_SDBND2_ADDR A:0x67899024
y.create.l HWIO_BLSP1_BLSP_BAM_BAM_P_PRDCR_SDBND3_ADDR A:0x6789a024
y.create.l HWIO_BLSP1_BLSP_BAM_BAM_P_PRDCR_SDBND4_ADDR A:0x6789b024
y.create.l HWIO_BLSP1_BLSP_BAM_BAM_P_PRDCR_SDBND5_ADDR A:0x6789c024
y.create.l HWIO_BLSP1_BLSP_BAM_BAM_P_PRDCR_SDBND6_ADDR A:0x6789d024
y.create.l HWIO_BLSP1_BLSP_BAM_BAM_P_PRDCR_SDBND7_ADDR A:0x6789e024
y.create.l HWIO_BLSP1_BLSP_BAM_BAM_P_PRDCR_SDBND8_ADDR A:0x6789f024
y.create.l HWIO_BLSP1_BLSP_BAM_BAM_P_PRDCR_SDBND9_ADDR A:0x678a0024
y.create.l HWIO_BLSP1_BLSP_BAM_BAM_P_CNSMR_SDBND0_ADDR A:0x67897028
y.create.l HWIO_BLSP1_BLSP_BAM_BAM_P_CNSMR_SDBND1_ADDR A:0x67898028
y.create.l HWIO_BLSP1_BLSP_BAM_BAM_P_CNSMR_SDBND2_ADDR A:0x67899028
y.create.l HWIO_BLSP1_BLSP_BAM_BAM_P_CNSMR_SDBND3_ADDR A:0x6789a028
y.create.l HWIO_BLSP1_BLSP_BAM_BAM_P_CNSMR_SDBND4_ADDR A:0x6789b028
y.create.l HWIO_BLSP1_BLSP_BAM_BAM_P_CNSMR_SDBND5_ADDR A:0x6789c028
y.create.l HWIO_BLSP1_BLSP_BAM_BAM_P_CNSMR_SDBND6_ADDR A:0x6789d028
y.create.l HWIO_BLSP1_BLSP_BAM_BAM_P_CNSMR_SDBND7_ADDR A:0x6789e028
y.create.l HWIO_BLSP1_BLSP_BAM_BAM_P_CNSMR_SDBND8_ADDR A:0x6789f028
y.create.l HWIO_BLSP1_BLSP_BAM_BAM_P_CNSMR_SDBND9_ADDR A:0x678a0028
y.create.l HWIO_BLSP1_BLSP_BAM_BAM_P_SW_OFSTS0_ADDR A:0x67897800
y.create.l HWIO_BLSP1_BLSP_BAM_BAM_P_SW_OFSTS1_ADDR A:0x67898800
y.create.l HWIO_BLSP1_BLSP_BAM_BAM_P_SW_OFSTS2_ADDR A:0x67899800
y.create.l HWIO_BLSP1_BLSP_BAM_BAM_P_SW_OFSTS3_ADDR A:0x6789a800
y.create.l HWIO_BLSP1_BLSP_BAM_BAM_P_SW_OFSTS4_ADDR A:0x6789b800
y.create.l HWIO_BLSP1_BLSP_BAM_BAM_P_SW_OFSTS5_ADDR A:0x6789c800
y.create.l HWIO_BLSP1_BLSP_BAM_BAM_P_SW_OFSTS6_ADDR A:0x6789d800
y.create.l HWIO_BLSP1_BLSP_BAM_BAM_P_SW_OFSTS7_ADDR A:0x6789e800
y.create.l HWIO_BLSP1_BLSP_BAM_BAM_P_SW_OFSTS8_ADDR A:0x6789f800
y.create.l HWIO_BLSP1_BLSP_BAM_BAM_P_SW_OFSTS9_ADDR A:0x678a0800
y.create.l HWIO_BLSP1_BLSP_BAM_BAM_P_AU_PSM_CNTXT_1_0_ADDR A:0x67897804
y.create.l HWIO_BLSP1_BLSP_BAM_BAM_P_AU_PSM_CNTXT_1_1_ADDR A:0x67898804
y.create.l HWIO_BLSP1_BLSP_BAM_BAM_P_AU_PSM_CNTXT_1_2_ADDR A:0x67899804
y.create.l HWIO_BLSP1_BLSP_BAM_BAM_P_AU_PSM_CNTXT_1_3_ADDR A:0x6789a804
y.create.l HWIO_BLSP1_BLSP_BAM_BAM_P_AU_PSM_CNTXT_1_4_ADDR A:0x6789b804
y.create.l HWIO_BLSP1_BLSP_BAM_BAM_P_AU_PSM_CNTXT_1_5_ADDR A:0x6789c804
y.create.l HWIO_BLSP1_BLSP_BAM_BAM_P_AU_PSM_CNTXT_1_6_ADDR A:0x6789d804
y.create.l HWIO_BLSP1_BLSP_BAM_BAM_P_AU_PSM_CNTXT_1_7_ADDR A:0x6789e804
y.create.l HWIO_BLSP1_BLSP_BAM_BAM_P_AU_PSM_CNTXT_1_8_ADDR A:0x6789f804
y.create.l HWIO_BLSP1_BLSP_BAM_BAM_P_AU_PSM_CNTXT_1_9_ADDR A:0x678a0804
y.create.l HWIO_BLSP1_BLSP_BAM_BAM_P_PSM_CNTXT_2_0_ADDR A:0x67897808
y.create.l HWIO_BLSP1_BLSP_BAM_BAM_P_PSM_CNTXT_2_1_ADDR A:0x67898808
y.create.l HWIO_BLSP1_BLSP_BAM_BAM_P_PSM_CNTXT_2_2_ADDR A:0x67899808
y.create.l HWIO_BLSP1_BLSP_BAM_BAM_P_PSM_CNTXT_2_3_ADDR A:0x6789a808
y.create.l HWIO_BLSP1_BLSP_BAM_BAM_P_PSM_CNTXT_2_4_ADDR A:0x6789b808
y.create.l HWIO_BLSP1_BLSP_BAM_BAM_P_PSM_CNTXT_2_5_ADDR A:0x6789c808
y.create.l HWIO_BLSP1_BLSP_BAM_BAM_P_PSM_CNTXT_2_6_ADDR A:0x6789d808
y.create.l HWIO_BLSP1_BLSP_BAM_BAM_P_PSM_CNTXT_2_7_ADDR A:0x6789e808
y.create.l HWIO_BLSP1_BLSP_BAM_BAM_P_PSM_CNTXT_2_8_ADDR A:0x6789f808
y.create.l HWIO_BLSP1_BLSP_BAM_BAM_P_PSM_CNTXT_2_9_ADDR A:0x678a0808
y.create.l HWIO_BLSP1_BLSP_BAM_BAM_P_PSM_CNTXT_3_0_ADDR A:0x6789780c
y.create.l HWIO_BLSP1_BLSP_BAM_BAM_P_PSM_CNTXT_3_1_ADDR A:0x6789880c
y.create.l HWIO_BLSP1_BLSP_BAM_BAM_P_PSM_CNTXT_3_2_ADDR A:0x6789980c
y.create.l HWIO_BLSP1_BLSP_BAM_BAM_P_PSM_CNTXT_3_3_ADDR A:0x6789a80c
y.create.l HWIO_BLSP1_BLSP_BAM_BAM_P_PSM_CNTXT_3_4_ADDR A:0x6789b80c
y.create.l HWIO_BLSP1_BLSP_BAM_BAM_P_PSM_CNTXT_3_5_ADDR A:0x6789c80c
y.create.l HWIO_BLSP1_BLSP_BAM_BAM_P_PSM_CNTXT_3_6_ADDR A:0x6789d80c
y.create.l HWIO_BLSP1_BLSP_BAM_BAM_P_PSM_CNTXT_3_7_ADDR A:0x6789e80c
y.create.l HWIO_BLSP1_BLSP_BAM_BAM_P_PSM_CNTXT_3_8_ADDR A:0x6789f80c
y.create.l HWIO_BLSP1_BLSP_BAM_BAM_P_PSM_CNTXT_3_9_ADDR A:0x678a080c
y.create.l HWIO_BLSP1_BLSP_BAM_BAM_P_PSM_CNTXT_4_0_ADDR A:0x67897810
y.create.l HWIO_BLSP1_BLSP_BAM_BAM_P_PSM_CNTXT_4_1_ADDR A:0x67898810
y.create.l HWIO_BLSP1_BLSP_BAM_BAM_P_PSM_CNTXT_4_2_ADDR A:0x67899810
y.create.l HWIO_BLSP1_BLSP_BAM_BAM_P_PSM_CNTXT_4_3_ADDR A:0x6789a810
y.create.l HWIO_BLSP1_BLSP_BAM_BAM_P_PSM_CNTXT_4_4_ADDR A:0x6789b810
y.create.l HWIO_BLSP1_BLSP_BAM_BAM_P_PSM_CNTXT_4_5_ADDR A:0x6789c810
y.create.l HWIO_BLSP1_BLSP_BAM_BAM_P_PSM_CNTXT_4_6_ADDR A:0x6789d810
y.create.l HWIO_BLSP1_BLSP_BAM_BAM_P_PSM_CNTXT_4_7_ADDR A:0x6789e810
y.create.l HWIO_BLSP1_BLSP_BAM_BAM_P_PSM_CNTXT_4_8_ADDR A:0x6789f810
y.create.l HWIO_BLSP1_BLSP_BAM_BAM_P_PSM_CNTXT_4_9_ADDR A:0x678a0810
y.create.l HWIO_BLSP1_BLSP_BAM_BAM_P_PSM_CNTXT_5_0_ADDR A:0x67897814
y.create.l HWIO_BLSP1_BLSP_BAM_BAM_P_PSM_CNTXT_5_1_ADDR A:0x67898814
y.create.l HWIO_BLSP1_BLSP_BAM_BAM_P_PSM_CNTXT_5_2_ADDR A:0x67899814
y.create.l HWIO_BLSP1_BLSP_BAM_BAM_P_PSM_CNTXT_5_3_ADDR A:0x6789a814
y.create.l HWIO_BLSP1_BLSP_BAM_BAM_P_PSM_CNTXT_5_4_ADDR A:0x6789b814
y.create.l HWIO_BLSP1_BLSP_BAM_BAM_P_PSM_CNTXT_5_5_ADDR A:0x6789c814
y.create.l HWIO_BLSP1_BLSP_BAM_BAM_P_PSM_CNTXT_5_6_ADDR A:0x6789d814
y.create.l HWIO_BLSP1_BLSP_BAM_BAM_P_PSM_CNTXT_5_7_ADDR A:0x6789e814
y.create.l HWIO_BLSP1_BLSP_BAM_BAM_P_PSM_CNTXT_5_8_ADDR A:0x6789f814
y.create.l HWIO_BLSP1_BLSP_BAM_BAM_P_PSM_CNTXT_5_9_ADDR A:0x678a0814
y.create.l HWIO_BLSP1_BLSP_BAM_BAM_P_EVNT_REG0_ADDR A:0x67897818
y.create.l HWIO_BLSP1_BLSP_BAM_BAM_P_EVNT_REG1_ADDR A:0x67898818
y.create.l HWIO_BLSP1_BLSP_BAM_BAM_P_EVNT_REG2_ADDR A:0x67899818
y.create.l HWIO_BLSP1_BLSP_BAM_BAM_P_EVNT_REG3_ADDR A:0x6789a818
y.create.l HWIO_BLSP1_BLSP_BAM_BAM_P_EVNT_REG4_ADDR A:0x6789b818
y.create.l HWIO_BLSP1_BLSP_BAM_BAM_P_EVNT_REG5_ADDR A:0x6789c818
y.create.l HWIO_BLSP1_BLSP_BAM_BAM_P_EVNT_REG6_ADDR A:0x6789d818
y.create.l HWIO_BLSP1_BLSP_BAM_BAM_P_EVNT_REG7_ADDR A:0x6789e818
y.create.l HWIO_BLSP1_BLSP_BAM_BAM_P_EVNT_REG8_ADDR A:0x6789f818
y.create.l HWIO_BLSP1_BLSP_BAM_BAM_P_EVNT_REG9_ADDR A:0x678a0818
y.create.l HWIO_BLSP1_BLSP_BAM_BAM_P_DESC_FIFO_ADDR0_ADDR A:0x6789781c
y.create.l HWIO_BLSP1_BLSP_BAM_BAM_P_DESC_FIFO_ADDR1_ADDR A:0x6789881c
y.create.l HWIO_BLSP1_BLSP_BAM_BAM_P_DESC_FIFO_ADDR2_ADDR A:0x6789981c
y.create.l HWIO_BLSP1_BLSP_BAM_BAM_P_DESC_FIFO_ADDR3_ADDR A:0x6789a81c
y.create.l HWIO_BLSP1_BLSP_BAM_BAM_P_DESC_FIFO_ADDR4_ADDR A:0x6789b81c
y.create.l HWIO_BLSP1_BLSP_BAM_BAM_P_DESC_FIFO_ADDR5_ADDR A:0x6789c81c
y.create.l HWIO_BLSP1_BLSP_BAM_BAM_P_DESC_FIFO_ADDR6_ADDR A:0x6789d81c
y.create.l HWIO_BLSP1_BLSP_BAM_BAM_P_DESC_FIFO_ADDR7_ADDR A:0x6789e81c
y.create.l HWIO_BLSP1_BLSP_BAM_BAM_P_DESC_FIFO_ADDR8_ADDR A:0x6789f81c
y.create.l HWIO_BLSP1_BLSP_BAM_BAM_P_DESC_FIFO_ADDR9_ADDR A:0x678a081c
y.create.l HWIO_BLSP1_BLSP_BAM_BAM_P_FIFO_SIZES0_ADDR A:0x67897820
y.create.l HWIO_BLSP1_BLSP_BAM_BAM_P_FIFO_SIZES1_ADDR A:0x67898820
y.create.l HWIO_BLSP1_BLSP_BAM_BAM_P_FIFO_SIZES2_ADDR A:0x67899820
y.create.l HWIO_BLSP1_BLSP_BAM_BAM_P_FIFO_SIZES3_ADDR A:0x6789a820
y.create.l HWIO_BLSP1_BLSP_BAM_BAM_P_FIFO_SIZES4_ADDR A:0x6789b820
y.create.l HWIO_BLSP1_BLSP_BAM_BAM_P_FIFO_SIZES5_ADDR A:0x6789c820
y.create.l HWIO_BLSP1_BLSP_BAM_BAM_P_FIFO_SIZES6_ADDR A:0x6789d820
y.create.l HWIO_BLSP1_BLSP_BAM_BAM_P_FIFO_SIZES7_ADDR A:0x6789e820
y.create.l HWIO_BLSP1_BLSP_BAM_BAM_P_FIFO_SIZES8_ADDR A:0x6789f820
y.create.l HWIO_BLSP1_BLSP_BAM_BAM_P_FIFO_SIZES9_ADDR A:0x678a0820
y.create.l HWIO_BLSP1_BLSP_BAM_BAM_P_DATA_FIFO_ADDR0_ADDR A:0x67897824
y.create.l HWIO_BLSP1_BLSP_BAM_BAM_P_DATA_FIFO_ADDR1_ADDR A:0x67898824
y.create.l HWIO_BLSP1_BLSP_BAM_BAM_P_DATA_FIFO_ADDR2_ADDR A:0x67899824
y.create.l HWIO_BLSP1_BLSP_BAM_BAM_P_DATA_FIFO_ADDR3_ADDR A:0x6789a824
y.create.l HWIO_BLSP1_BLSP_BAM_BAM_P_DATA_FIFO_ADDR4_ADDR A:0x6789b824
y.create.l HWIO_BLSP1_BLSP_BAM_BAM_P_DATA_FIFO_ADDR5_ADDR A:0x6789c824
y.create.l HWIO_BLSP1_BLSP_BAM_BAM_P_DATA_FIFO_ADDR6_ADDR A:0x6789d824
y.create.l HWIO_BLSP1_BLSP_BAM_BAM_P_DATA_FIFO_ADDR7_ADDR A:0x6789e824
y.create.l HWIO_BLSP1_BLSP_BAM_BAM_P_DATA_FIFO_ADDR8_ADDR A:0x6789f824
y.create.l HWIO_BLSP1_BLSP_BAM_BAM_P_DATA_FIFO_ADDR9_ADDR A:0x678a0824
y.create.l HWIO_BLSP1_BLSP_BAM_BAM_P_EVNT_GEN_TRSHLD0_ADDR A:0x67897828
y.create.l HWIO_BLSP1_BLSP_BAM_BAM_P_EVNT_GEN_TRSHLD1_ADDR A:0x67898828
y.create.l HWIO_BLSP1_BLSP_BAM_BAM_P_EVNT_GEN_TRSHLD2_ADDR A:0x67899828
y.create.l HWIO_BLSP1_BLSP_BAM_BAM_P_EVNT_GEN_TRSHLD3_ADDR A:0x6789a828
y.create.l HWIO_BLSP1_BLSP_BAM_BAM_P_EVNT_GEN_TRSHLD4_ADDR A:0x6789b828
y.create.l HWIO_BLSP1_BLSP_BAM_BAM_P_EVNT_GEN_TRSHLD5_ADDR A:0x6789c828
y.create.l HWIO_BLSP1_BLSP_BAM_BAM_P_EVNT_GEN_TRSHLD6_ADDR A:0x6789d828
y.create.l HWIO_BLSP1_BLSP_BAM_BAM_P_EVNT_GEN_TRSHLD7_ADDR A:0x6789e828
y.create.l HWIO_BLSP1_BLSP_BAM_BAM_P_EVNT_GEN_TRSHLD8_ADDR A:0x6789f828
y.create.l HWIO_BLSP1_BLSP_BAM_BAM_P_EVNT_GEN_TRSHLD9_ADDR A:0x678a0828
y.create.l HWIO_BLSP1_BLSP_BAM_BAM_P_EVNT_DEST_ADDR0_ADDR A:0x6789782c
y.create.l HWIO_BLSP1_BLSP_BAM_BAM_P_EVNT_DEST_ADDR1_ADDR A:0x6789882c
y.create.l HWIO_BLSP1_BLSP_BAM_BAM_P_EVNT_DEST_ADDR2_ADDR A:0x6789982c
y.create.l HWIO_BLSP1_BLSP_BAM_BAM_P_EVNT_DEST_ADDR3_ADDR A:0x6789a82c
y.create.l HWIO_BLSP1_BLSP_BAM_BAM_P_EVNT_DEST_ADDR4_ADDR A:0x6789b82c
y.create.l HWIO_BLSP1_BLSP_BAM_BAM_P_EVNT_DEST_ADDR5_ADDR A:0x6789c82c
y.create.l HWIO_BLSP1_BLSP_BAM_BAM_P_EVNT_DEST_ADDR6_ADDR A:0x6789d82c
y.create.l HWIO_BLSP1_BLSP_BAM_BAM_P_EVNT_DEST_ADDR7_ADDR A:0x6789e82c
y.create.l HWIO_BLSP1_BLSP_BAM_BAM_P_EVNT_DEST_ADDR8_ADDR A:0x6789f82c
y.create.l HWIO_BLSP1_BLSP_BAM_BAM_P_EVNT_DEST_ADDR9_ADDR A:0x678a082c
y.create.l HWIO_BLSP1_BLSP_BAM_BAM_P_DF_CNTXT_0_ADDR A:0x67897830
y.create.l HWIO_BLSP1_BLSP_BAM_BAM_P_DF_CNTXT_1_ADDR A:0x67898830
y.create.l HWIO_BLSP1_BLSP_BAM_BAM_P_DF_CNTXT_2_ADDR A:0x67899830
y.create.l HWIO_BLSP1_BLSP_BAM_BAM_P_DF_CNTXT_3_ADDR A:0x6789a830
y.create.l HWIO_BLSP1_BLSP_BAM_BAM_P_DF_CNTXT_4_ADDR A:0x6789b830
y.create.l HWIO_BLSP1_BLSP_BAM_BAM_P_DF_CNTXT_5_ADDR A:0x6789c830
y.create.l HWIO_BLSP1_BLSP_BAM_BAM_P_DF_CNTXT_6_ADDR A:0x6789d830
y.create.l HWIO_BLSP1_BLSP_BAM_BAM_P_DF_CNTXT_7_ADDR A:0x6789e830
y.create.l HWIO_BLSP1_BLSP_BAM_BAM_P_DF_CNTXT_8_ADDR A:0x6789f830
y.create.l HWIO_BLSP1_BLSP_BAM_BAM_P_DF_CNTXT_9_ADDR A:0x678a0830
y.create.l HWIO_BLSP1_BLSP_BAM_BAM_P_RETR_CNTXT_0_ADDR A:0x67897834
y.create.l HWIO_BLSP1_BLSP_BAM_BAM_P_RETR_CNTXT_1_ADDR A:0x67898834
y.create.l HWIO_BLSP1_BLSP_BAM_BAM_P_RETR_CNTXT_2_ADDR A:0x67899834
y.create.l HWIO_BLSP1_BLSP_BAM_BAM_P_RETR_CNTXT_3_ADDR A:0x6789a834
y.create.l HWIO_BLSP1_BLSP_BAM_BAM_P_RETR_CNTXT_4_ADDR A:0x6789b834
y.create.l HWIO_BLSP1_BLSP_BAM_BAM_P_RETR_CNTXT_5_ADDR A:0x6789c834
y.create.l HWIO_BLSP1_BLSP_BAM_BAM_P_RETR_CNTXT_6_ADDR A:0x6789d834
y.create.l HWIO_BLSP1_BLSP_BAM_BAM_P_RETR_CNTXT_7_ADDR A:0x6789e834
y.create.l HWIO_BLSP1_BLSP_BAM_BAM_P_RETR_CNTXT_8_ADDR A:0x6789f834
y.create.l HWIO_BLSP1_BLSP_BAM_BAM_P_RETR_CNTXT_9_ADDR A:0x678a0834
y.create.l HWIO_BLSP1_BLSP_BAM_BAM_P_SI_CNTXT_0_ADDR A:0x67897838
y.create.l HWIO_BLSP1_BLSP_BAM_BAM_P_SI_CNTXT_1_ADDR A:0x67898838
y.create.l HWIO_BLSP1_BLSP_BAM_BAM_P_SI_CNTXT_2_ADDR A:0x67899838
y.create.l HWIO_BLSP1_BLSP_BAM_BAM_P_SI_CNTXT_3_ADDR A:0x6789a838
y.create.l HWIO_BLSP1_BLSP_BAM_BAM_P_SI_CNTXT_4_ADDR A:0x6789b838
y.create.l HWIO_BLSP1_BLSP_BAM_BAM_P_SI_CNTXT_5_ADDR A:0x6789c838
y.create.l HWIO_BLSP1_BLSP_BAM_BAM_P_SI_CNTXT_6_ADDR A:0x6789d838
y.create.l HWIO_BLSP1_BLSP_BAM_BAM_P_SI_CNTXT_7_ADDR A:0x6789e838
y.create.l HWIO_BLSP1_BLSP_BAM_BAM_P_SI_CNTXT_8_ADDR A:0x6789f838
y.create.l HWIO_BLSP1_BLSP_BAM_BAM_P_SI_CNTXT_9_ADDR A:0x678a0838
y.create.l HWIO_BLSP1_BLSP_BAM_BAM_P_PSM_CNTXT_3_LSB0_ADDR A:0x67897900
y.create.l HWIO_BLSP1_BLSP_BAM_BAM_P_PSM_CNTXT_3_LSB1_ADDR A:0x67898900
y.create.l HWIO_BLSP1_BLSP_BAM_BAM_P_PSM_CNTXT_3_LSB2_ADDR A:0x67899900
y.create.l HWIO_BLSP1_BLSP_BAM_BAM_P_PSM_CNTXT_3_LSB3_ADDR A:0x6789a900
y.create.l HWIO_BLSP1_BLSP_BAM_BAM_P_PSM_CNTXT_3_LSB4_ADDR A:0x6789b900
y.create.l HWIO_BLSP1_BLSP_BAM_BAM_P_PSM_CNTXT_3_LSB5_ADDR A:0x6789c900
y.create.l HWIO_BLSP1_BLSP_BAM_BAM_P_PSM_CNTXT_3_LSB6_ADDR A:0x6789d900
y.create.l HWIO_BLSP1_BLSP_BAM_BAM_P_PSM_CNTXT_3_LSB7_ADDR A:0x6789e900
y.create.l HWIO_BLSP1_BLSP_BAM_BAM_P_PSM_CNTXT_3_LSB8_ADDR A:0x6789f900
y.create.l HWIO_BLSP1_BLSP_BAM_BAM_P_PSM_CNTXT_3_LSB9_ADDR A:0x678a0900
y.create.l HWIO_BLSP1_BLSP_BAM_BAM_P_PSM_CNTXT_3_MSB0_ADDR A:0x67897904
y.create.l HWIO_BLSP1_BLSP_BAM_BAM_P_PSM_CNTXT_3_MSB1_ADDR A:0x67898904
y.create.l HWIO_BLSP1_BLSP_BAM_BAM_P_PSM_CNTXT_3_MSB2_ADDR A:0x67899904
y.create.l HWIO_BLSP1_BLSP_BAM_BAM_P_PSM_CNTXT_3_MSB3_ADDR A:0x6789a904
y.create.l HWIO_BLSP1_BLSP_BAM_BAM_P_PSM_CNTXT_3_MSB4_ADDR A:0x6789b904
y.create.l HWIO_BLSP1_BLSP_BAM_BAM_P_PSM_CNTXT_3_MSB5_ADDR A:0x6789c904
y.create.l HWIO_BLSP1_BLSP_BAM_BAM_P_PSM_CNTXT_3_MSB6_ADDR A:0x6789d904
y.create.l HWIO_BLSP1_BLSP_BAM_BAM_P_PSM_CNTXT_3_MSB7_ADDR A:0x6789e904
y.create.l HWIO_BLSP1_BLSP_BAM_BAM_P_PSM_CNTXT_3_MSB8_ADDR A:0x6789f904
y.create.l HWIO_BLSP1_BLSP_BAM_BAM_P_PSM_CNTXT_3_MSB9_ADDR A:0x678a0904
y.create.l HWIO_BLSP1_BLSP_BAM_BAM_P_DESC_FIFO_ADDR_LSB0_ADDR A:0x67897910
y.create.l HWIO_BLSP1_BLSP_BAM_BAM_P_DESC_FIFO_ADDR_LSB1_ADDR A:0x67898910
y.create.l HWIO_BLSP1_BLSP_BAM_BAM_P_DESC_FIFO_ADDR_LSB2_ADDR A:0x67899910
y.create.l HWIO_BLSP1_BLSP_BAM_BAM_P_DESC_FIFO_ADDR_LSB3_ADDR A:0x6789a910
y.create.l HWIO_BLSP1_BLSP_BAM_BAM_P_DESC_FIFO_ADDR_LSB4_ADDR A:0x6789b910
y.create.l HWIO_BLSP1_BLSP_BAM_BAM_P_DESC_FIFO_ADDR_LSB5_ADDR A:0x6789c910
y.create.l HWIO_BLSP1_BLSP_BAM_BAM_P_DESC_FIFO_ADDR_LSB6_ADDR A:0x6789d910
y.create.l HWIO_BLSP1_BLSP_BAM_BAM_P_DESC_FIFO_ADDR_LSB7_ADDR A:0x6789e910
y.create.l HWIO_BLSP1_BLSP_BAM_BAM_P_DESC_FIFO_ADDR_LSB8_ADDR A:0x6789f910
y.create.l HWIO_BLSP1_BLSP_BAM_BAM_P_DESC_FIFO_ADDR_LSB9_ADDR A:0x678a0910
y.create.l HWIO_BLSP1_BLSP_BAM_BAM_P_DESC_FIFO_ADDR_MSB0_ADDR A:0x67897914
y.create.l HWIO_BLSP1_BLSP_BAM_BAM_P_DESC_FIFO_ADDR_MSB1_ADDR A:0x67898914
y.create.l HWIO_BLSP1_BLSP_BAM_BAM_P_DESC_FIFO_ADDR_MSB2_ADDR A:0x67899914
y.create.l HWIO_BLSP1_BLSP_BAM_BAM_P_DESC_FIFO_ADDR_MSB3_ADDR A:0x6789a914
y.create.l HWIO_BLSP1_BLSP_BAM_BAM_P_DESC_FIFO_ADDR_MSB4_ADDR A:0x6789b914
y.create.l HWIO_BLSP1_BLSP_BAM_BAM_P_DESC_FIFO_ADDR_MSB5_ADDR A:0x6789c914
y.create.l HWIO_BLSP1_BLSP_BAM_BAM_P_DESC_FIFO_ADDR_MSB6_ADDR A:0x6789d914
y.create.l HWIO_BLSP1_BLSP_BAM_BAM_P_DESC_FIFO_ADDR_MSB7_ADDR A:0x6789e914
y.create.l HWIO_BLSP1_BLSP_BAM_BAM_P_DESC_FIFO_ADDR_MSB8_ADDR A:0x6789f914
y.create.l HWIO_BLSP1_BLSP_BAM_BAM_P_DESC_FIFO_ADDR_MSB9_ADDR A:0x678a0914
y.create.l HWIO_BLSP1_BLSP_BAM_BAM_P_DATA_FIFO_ADDR_LSB0_ADDR A:0x67897920
y.create.l HWIO_BLSP1_BLSP_BAM_BAM_P_DATA_FIFO_ADDR_LSB1_ADDR A:0x67898920
y.create.l HWIO_BLSP1_BLSP_BAM_BAM_P_DATA_FIFO_ADDR_LSB2_ADDR A:0x67899920
y.create.l HWIO_BLSP1_BLSP_BAM_BAM_P_DATA_FIFO_ADDR_LSB3_ADDR A:0x6789a920
y.create.l HWIO_BLSP1_BLSP_BAM_BAM_P_DATA_FIFO_ADDR_LSB4_ADDR A:0x6789b920
y.create.l HWIO_BLSP1_BLSP_BAM_BAM_P_DATA_FIFO_ADDR_LSB5_ADDR A:0x6789c920
y.create.l HWIO_BLSP1_BLSP_BAM_BAM_P_DATA_FIFO_ADDR_LSB6_ADDR A:0x6789d920
y.create.l HWIO_BLSP1_BLSP_BAM_BAM_P_DATA_FIFO_ADDR_LSB7_ADDR A:0x6789e920
y.create.l HWIO_BLSP1_BLSP_BAM_BAM_P_DATA_FIFO_ADDR_LSB8_ADDR A:0x6789f920
y.create.l HWIO_BLSP1_BLSP_BAM_BAM_P_DATA_FIFO_ADDR_LSB9_ADDR A:0x678a0920
y.create.l HWIO_BLSP1_BLSP_BAM_BAM_P_DATA_FIFO_ADDR_MSB0_ADDR A:0x67897924
y.create.l HWIO_BLSP1_BLSP_BAM_BAM_P_DATA_FIFO_ADDR_MSB1_ADDR A:0x67898924
y.create.l HWIO_BLSP1_BLSP_BAM_BAM_P_DATA_FIFO_ADDR_MSB2_ADDR A:0x67899924
y.create.l HWIO_BLSP1_BLSP_BAM_BAM_P_DATA_FIFO_ADDR_MSB3_ADDR A:0x6789a924
y.create.l HWIO_BLSP1_BLSP_BAM_BAM_P_DATA_FIFO_ADDR_MSB4_ADDR A:0x6789b924
y.create.l HWIO_BLSP1_BLSP_BAM_BAM_P_DATA_FIFO_ADDR_MSB5_ADDR A:0x6789c924
y.create.l HWIO_BLSP1_BLSP_BAM_BAM_P_DATA_FIFO_ADDR_MSB6_ADDR A:0x6789d924
y.create.l HWIO_BLSP1_BLSP_BAM_BAM_P_DATA_FIFO_ADDR_MSB7_ADDR A:0x6789e924
y.create.l HWIO_BLSP1_BLSP_BAM_BAM_P_DATA_FIFO_ADDR_MSB8_ADDR A:0x6789f924
y.create.l HWIO_BLSP1_BLSP_BAM_BAM_P_DATA_FIFO_ADDR_MSB9_ADDR A:0x678a0924
y.create.l HWIO_BLSP1_BLSP_BAM_BAM_P_EVNT_DEST_ADDR_LSB0_ADDR A:0x67897930
y.create.l HWIO_BLSP1_BLSP_BAM_BAM_P_EVNT_DEST_ADDR_LSB1_ADDR A:0x67898930
y.create.l HWIO_BLSP1_BLSP_BAM_BAM_P_EVNT_DEST_ADDR_LSB2_ADDR A:0x67899930
y.create.l HWIO_BLSP1_BLSP_BAM_BAM_P_EVNT_DEST_ADDR_LSB3_ADDR A:0x6789a930
y.create.l HWIO_BLSP1_BLSP_BAM_BAM_P_EVNT_DEST_ADDR_LSB4_ADDR A:0x6789b930
y.create.l HWIO_BLSP1_BLSP_BAM_BAM_P_EVNT_DEST_ADDR_LSB5_ADDR A:0x6789c930
y.create.l HWIO_BLSP1_BLSP_BAM_BAM_P_EVNT_DEST_ADDR_LSB6_ADDR A:0x6789d930
y.create.l HWIO_BLSP1_BLSP_BAM_BAM_P_EVNT_DEST_ADDR_LSB7_ADDR A:0x6789e930
y.create.l HWIO_BLSP1_BLSP_BAM_BAM_P_EVNT_DEST_ADDR_LSB8_ADDR A:0x6789f930
y.create.l HWIO_BLSP1_BLSP_BAM_BAM_P_EVNT_DEST_ADDR_LSB9_ADDR A:0x678a0930
y.create.l HWIO_BLSP1_BLSP_BAM_BAM_P_EVNT_DEST_ADDR_MSB0_ADDR A:0x67897934
y.create.l HWIO_BLSP1_BLSP_BAM_BAM_P_EVNT_DEST_ADDR_MSB1_ADDR A:0x67898934
y.create.l HWIO_BLSP1_BLSP_BAM_BAM_P_EVNT_DEST_ADDR_MSB2_ADDR A:0x67899934
y.create.l HWIO_BLSP1_BLSP_BAM_BAM_P_EVNT_DEST_ADDR_MSB3_ADDR A:0x6789a934
y.create.l HWIO_BLSP1_BLSP_BAM_BAM_P_EVNT_DEST_ADDR_MSB4_ADDR A:0x6789b934
y.create.l HWIO_BLSP1_BLSP_BAM_BAM_P_EVNT_DEST_ADDR_MSB5_ADDR A:0x6789c934
y.create.l HWIO_BLSP1_BLSP_BAM_BAM_P_EVNT_DEST_ADDR_MSB6_ADDR A:0x6789d934
y.create.l HWIO_BLSP1_BLSP_BAM_BAM_P_EVNT_DEST_ADDR_MSB7_ADDR A:0x6789e934
y.create.l HWIO_BLSP1_BLSP_BAM_BAM_P_EVNT_DEST_ADDR_MSB8_ADDR A:0x6789f934
y.create.l HWIO_BLSP1_BLSP_BAM_BAM_P_EVNT_DEST_ADDR_MSB9_ADDR A:0x678a0934
y.create.l HWIO_BLSP1_BLSP_BAM_XPU_SCR_ADDR A:0x67882000
y.create.l HWIO_BLSP1_BLSP_BAM_XPU_SWDR_ADDR A:0x67882004
y.create.l HWIO_BLSP1_BLSP_BAM_XPU_SEAR0_ADDR A:0x67882040
y.create.l HWIO_BLSP1_BLSP_BAM_XPU_SESR_ADDR A:0x67882048
y.create.l HWIO_BLSP1_BLSP_BAM_XPU_SESRRESTORE_ADDR A:0x6788204c
y.create.l HWIO_BLSP1_BLSP_BAM_XPU_SESYNR0_ADDR A:0x67882050
y.create.l HWIO_BLSP1_BLSP_BAM_XPU_SESYNR1_ADDR A:0x67882054
y.create.l HWIO_BLSP1_BLSP_BAM_XPU_SESYNR2_ADDR A:0x67882058
y.create.l HWIO_BLSP1_BLSP_BAM_XPU_MCR_ADDR A:0x67882100
y.create.l HWIO_BLSP1_BLSP_BAM_XPU_MEAR0_ADDR A:0x67882140
y.create.l HWIO_BLSP1_BLSP_BAM_XPU_MESR_ADDR A:0x67882148
y.create.l HWIO_BLSP1_BLSP_BAM_XPU_MESRRESTORE_ADDR A:0x6788214c
y.create.l HWIO_BLSP1_BLSP_BAM_XPU_MESYNR0_ADDR A:0x67882150
y.create.l HWIO_BLSP1_BLSP_BAM_XPU_MESYNR1_ADDR A:0x67882154
y.create.l HWIO_BLSP1_BLSP_BAM_XPU_MESYNR2_ADDR A:0x67882158
y.create.l HWIO_BLSP1_BLSP_BAM_XPU_CR_ADDR A:0x67882080
y.create.l HWIO_BLSP1_BLSP_BAM_XPU_RPU_ACR0_ADDR A:0x678820a0
y.create.l HWIO_BLSP1_BLSP_BAM_XPU_EAR0_ADDR A:0x678820c0
y.create.l HWIO_BLSP1_BLSP_BAM_XPU_ESR_ADDR A:0x678820c8
y.create.l HWIO_BLSP1_BLSP_BAM_XPU_ESRRESTORE_ADDR A:0x678820cc
y.create.l HWIO_BLSP1_BLSP_BAM_XPU_ESYNR0_ADDR A:0x678820d0
y.create.l HWIO_BLSP1_BLSP_BAM_XPU_ESYNR1_ADDR A:0x678820d4
y.create.l HWIO_BLSP1_BLSP_BAM_XPU_ESYNR2_ADDR A:0x678820d8
y.create.l HWIO_BLSP1_BLSP_BAM_XPU_IDR0_ADDR A:0x67882074
y.create.l HWIO_BLSP1_BLSP_BAM_XPU_IDR1_ADDR A:0x67882078
y.create.l HWIO_BLSP1_BLSP_BAM_XPU_REV_ADDR A:0x6788207c
y.create.l HWIO_BLSP1_BLSP_BAM_XPU_RG0_RACR0_ADDR A:0x67882200
y.create.l HWIO_BLSP1_BLSP_BAM_XPU_RG1_RACR0_ADDR A:0x67882280
y.create.l HWIO_BLSP1_BLSP_BAM_XPU_RG2_RACR0_ADDR A:0x67882300
y.create.l HWIO_BLSP1_BLSP_BAM_XPU_RG3_RACR0_ADDR A:0x67882380
y.create.l HWIO_BLSP1_BLSP_BAM_XPU_RG4_RACR0_ADDR A:0x67882400
y.create.l HWIO_BLSP1_BLSP_BAM_XPU_RG5_RACR0_ADDR A:0x67882480
y.create.l HWIO_BLSP1_BLSP_BAM_XPU_RG6_RACR0_ADDR A:0x67882500
y.create.l HWIO_BLSP1_BLSP_BAM_XPU_RG7_RACR0_ADDR A:0x67882580
y.create.l HWIO_BLSP1_BLSP_BAM_XPU_RG8_RACR0_ADDR A:0x67882600
y.create.l HWIO_BLSP1_BLSP_BAM_XPU_RG9_RACR0_ADDR A:0x67882680
y.create.l HWIO_BLSP1_BLSP_BAM_XPU_RG0_SCR_ADDR A:0x67882250
y.create.l HWIO_BLSP1_BLSP_BAM_XPU_RG1_SCR_ADDR A:0x678822d0
y.create.l HWIO_BLSP1_BLSP_BAM_XPU_RG2_SCR_ADDR A:0x67882350
y.create.l HWIO_BLSP1_BLSP_BAM_XPU_RG3_SCR_ADDR A:0x678823d0
y.create.l HWIO_BLSP1_BLSP_BAM_XPU_RG4_SCR_ADDR A:0x67882450
y.create.l HWIO_BLSP1_BLSP_BAM_XPU_RG5_SCR_ADDR A:0x678824d0
y.create.l HWIO_BLSP1_BLSP_BAM_XPU_RG6_SCR_ADDR A:0x67882550
y.create.l HWIO_BLSP1_BLSP_BAM_XPU_RG7_SCR_ADDR A:0x678825d0
y.create.l HWIO_BLSP1_BLSP_BAM_XPU_RG8_SCR_ADDR A:0x67882650
y.create.l HWIO_BLSP1_BLSP_BAM_XPU_RG9_SCR_ADDR A:0x678826d0
y.create.l HWIO_BLSP1_BLSP_BAM_XPU_RG0_MCR_ADDR A:0x67882254
y.create.l HWIO_BLSP1_BLSP_BAM_XPU_RG1_MCR_ADDR A:0x678822d4
y.create.l HWIO_BLSP1_BLSP_BAM_XPU_RG2_MCR_ADDR A:0x67882354
y.create.l HWIO_BLSP1_BLSP_BAM_XPU_RG3_MCR_ADDR A:0x678823d4
y.create.l HWIO_BLSP1_BLSP_BAM_XPU_RG4_MCR_ADDR A:0x67882454
y.create.l HWIO_BLSP1_BLSP_BAM_XPU_RG5_MCR_ADDR A:0x678824d4
y.create.l HWIO_BLSP1_BLSP_BAM_XPU_RG6_MCR_ADDR A:0x67882554
y.create.l HWIO_BLSP1_BLSP_BAM_XPU_RG7_MCR_ADDR A:0x678825d4
y.create.l HWIO_BLSP1_BLSP_BAM_XPU_RG8_MCR_ADDR A:0x67882654
y.create.l HWIO_BLSP1_BLSP_BAM_XPU_RG9_MCR_ADDR A:0x678826d4
y.create.l HWIO_BLSP1_BLSP_BAM_VMIDMT_SCR0_ADDR A:0x67880000
y.create.l HWIO_BLSP1_BLSP_BAM_VMIDMT_SCR1_ADDR A:0x67880004
y.create.l HWIO_BLSP1_BLSP_BAM_VMIDMT_SCR2_ADDR A:0x67880008
y.create.l HWIO_BLSP1_BLSP_BAM_VMIDMT_SACR_ADDR A:0x67880010
y.create.l HWIO_BLSP1_BLSP_BAM_VMIDMT_SIDR0_ADDR A:0x67880020
y.create.l HWIO_BLSP1_BLSP_BAM_VMIDMT_SIDR1_ADDR A:0x67880024
y.create.l HWIO_BLSP1_BLSP_BAM_VMIDMT_SIDR2_ADDR A:0x67880028
y.create.l HWIO_BLSP1_BLSP_BAM_VMIDMT_SIDR4_ADDR A:0x67880030
y.create.l HWIO_BLSP1_BLSP_BAM_VMIDMT_SIDR5_ADDR A:0x67880034
y.create.l HWIO_BLSP1_BLSP_BAM_VMIDMT_SIDR7_ADDR A:0x6788003c
y.create.l HWIO_BLSP1_BLSP_BAM_VMIDMT_SGFAR0_ADDR A:0x67880040
y.create.l HWIO_BLSP1_BLSP_BAM_VMIDMT_SGFSR_ADDR A:0x67880048
y.create.l HWIO_BLSP1_BLSP_BAM_VMIDMT_SGFSRRESTORE_ADDR A:0x6788004c
y.create.l HWIO_BLSP1_BLSP_BAM_VMIDMT_SGFSYNDR0_ADDR A:0x67880050
y.create.l HWIO_BLSP1_BLSP_BAM_VMIDMT_SGFSYNDR1_ADDR A:0x67880054
y.create.l HWIO_BLSP1_BLSP_BAM_VMIDMT_SGFSYNDR2_ADDR A:0x67880058
y.create.l HWIO_BLSP1_BLSP_BAM_VMIDMT_VMIDMTSCR0_ADDR A:0x67880090
y.create.l HWIO_BLSP1_BLSP_BAM_VMIDMT_CR0_ADDR A:0x67880000
y.create.l HWIO_BLSP1_BLSP_BAM_VMIDMT_CR2_ADDR A:0x67880008
y.create.l HWIO_BLSP1_BLSP_BAM_VMIDMT_ACR_ADDR A:0x67880010
y.create.l HWIO_BLSP1_BLSP_BAM_VMIDMT_IDR0_ADDR A:0x67880020
y.create.l HWIO_BLSP1_BLSP_BAM_VMIDMT_IDR1_ADDR A:0x67880024
y.create.l HWIO_BLSP1_BLSP_BAM_VMIDMT_IDR2_ADDR A:0x67880028
y.create.l HWIO_BLSP1_BLSP_BAM_VMIDMT_IDR4_ADDR A:0x67880030
y.create.l HWIO_BLSP1_BLSP_BAM_VMIDMT_IDR5_ADDR A:0x67880034
y.create.l HWIO_BLSP1_BLSP_BAM_VMIDMT_IDR7_ADDR A:0x6788003c
y.create.l HWIO_BLSP1_BLSP_BAM_VMIDMT_GFAR0_ADDR A:0x67880040
y.create.l HWIO_BLSP1_BLSP_BAM_VMIDMT_GFSR_ADDR A:0x67880048
y.create.l HWIO_BLSP1_BLSP_BAM_VMIDMT_GFSRRESTORE_ADDR A:0x6788004c
y.create.l HWIO_BLSP1_BLSP_BAM_VMIDMT_GFSYNDR0_ADDR A:0x67880050
y.create.l HWIO_BLSP1_BLSP_BAM_VMIDMT_GFSYNDR1_ADDR A:0x67880054
y.create.l HWIO_BLSP1_BLSP_BAM_VMIDMT_GFSYNDR2_ADDR A:0x67880058
y.create.l HWIO_BLSP1_BLSP_BAM_VMIDMT_VMIDMTCR0_ADDR A:0x67880090
y.create.l HWIO_BLSP1_BLSP_BAM_VMIDMT_VMIDMTACR_ADDR A:0x6788009c
y.create.l HWIO_BLSP1_BLSP_BAM_VMIDMT_NSCR0_ADDR A:0x67880400
y.create.l HWIO_BLSP1_BLSP_BAM_VMIDMT_NSCR2_ADDR A:0x67880408
y.create.l HWIO_BLSP1_BLSP_BAM_VMIDMT_NSACR_ADDR A:0x67880410
y.create.l HWIO_BLSP1_BLSP_BAM_VMIDMT_NSGFAR0_ADDR A:0x67880440
y.create.l HWIO_BLSP1_BLSP_BAM_VMIDMT_NSGFSR_ADDR A:0x67880448
y.create.l HWIO_BLSP1_BLSP_BAM_VMIDMT_NSGFSRRESTORE_ADDR A:0x6788044c
y.create.l HWIO_BLSP1_BLSP_BAM_VMIDMT_NSGFSYNDR0_ADDR A:0x67880450
y.create.l HWIO_BLSP1_BLSP_BAM_VMIDMT_NSGFSYNDR1_ADDR A:0x67880454
y.create.l HWIO_BLSP1_BLSP_BAM_VMIDMT_NSGFSYNDR2_ADDR A:0x67880458
y.create.l HWIO_BLSP1_BLSP_BAM_VMIDMT_NSVMIDMTCR0_ADDR A:0x67880490
y.create.l HWIO_BLSP1_BLSP_BAM_VMIDMT_SSDR0_ADDR A:0x67880080
y.create.l HWIO_BLSP1_BLSP_BAM_VMIDMT_MSDR0_ADDR A:0x67880480
y.create.l HWIO_BLSP1_BLSP_BAM_VMIDMT_MCR_ADDR A:0x67880494
y.create.l HWIO_BLSP1_BLSP_BAM_VMIDMT_S2VR0_ADDR A:0x67880c00
y.create.l HWIO_BLSP1_BLSP_BAM_VMIDMT_S2VR1_ADDR A:0x67880c04
y.create.l HWIO_BLSP1_BLSP_BAM_VMIDMT_S2VR2_ADDR A:0x67880c08
y.create.l HWIO_BLSP1_BLSP_BAM_VMIDMT_S2VR3_ADDR A:0x67880c0c
y.create.l HWIO_BLSP1_BLSP_BAM_VMIDMT_S2VR4_ADDR A:0x67880c10
y.create.l HWIO_BLSP1_BLSP_BAM_VMIDMT_S2VR5_ADDR A:0x67880c14
y.create.l HWIO_BLSP1_BLSP_BAM_VMIDMT_S2VR6_ADDR A:0x67880c18
y.create.l HWIO_BLSP1_BLSP_BAM_VMIDMT_S2VR7_ADDR A:0x67880c1c
y.create.l HWIO_BLSP1_BLSP_BAM_VMIDMT_S2VR8_ADDR A:0x67880c20
y.create.l HWIO_BLSP1_BLSP_BAM_VMIDMT_S2VR9_ADDR A:0x67880c24
y.create.l HWIO_BLSP1_BLSP_BAM_VMIDMT_AS2VR0_ADDR A:0x67880e00
y.create.l HWIO_BLSP1_BLSP_BAM_VMIDMT_AS2VR1_ADDR A:0x67880e04
y.create.l HWIO_BLSP1_BLSP_BAM_VMIDMT_AS2VR2_ADDR A:0x67880e08
y.create.l HWIO_BLSP1_BLSP_BAM_VMIDMT_AS2VR3_ADDR A:0x67880e0c
y.create.l HWIO_BLSP1_BLSP_BAM_VMIDMT_AS2VR4_ADDR A:0x67880e10
y.create.l HWIO_BLSP1_BLSP_BAM_VMIDMT_AS2VR5_ADDR A:0x67880e14
y.create.l HWIO_BLSP1_BLSP_BAM_VMIDMT_AS2VR6_ADDR A:0x67880e18
y.create.l HWIO_BLSP1_BLSP_BAM_VMIDMT_AS2VR7_ADDR A:0x67880e1c
y.create.l HWIO_BLSP1_BLSP_BAM_VMIDMT_AS2VR8_ADDR A:0x67880e20
y.create.l HWIO_BLSP1_BLSP_BAM_VMIDMT_AS2VR9_ADDR A:0x67880e24
y.create.l HWIO_BLSP1_BLSP_BAM_VMIDMT_SMR0_ADDR A:0x67880800
y.create.l HWIO_BLSP1_BLSP_BAM_VMIDMT_SMR1_ADDR A:0x67880804
y.create.l HWIO_BLSP1_BLSP_BAM_VMIDMT_SMR2_ADDR A:0x67880808
y.create.l HWIO_BLSP1_BLSP_BAM_VMIDMT_SMR3_ADDR A:0x6788080c
y.create.l HWIO_BLSP1_BLSP_BAM_VMIDMT_SMR4_ADDR A:0x67880810
y.create.l HWIO_BLSP1_BLSP_BAM_VMIDMT_SMR5_ADDR A:0x67880814
y.create.l HWIO_BLSP1_BLSP_BAM_VMIDMT_SMR6_ADDR A:0x67880818
y.create.l HWIO_BLSP1_BLSP_BAM_VMIDMT_SMR7_ADDR A:0x6788081c
y.create.l HWIO_BLSP1_BLSP_BAM_VMIDMT_SMR8_ADDR A:0x67880820
y.create.l HWIO_BLSP1_BLSP_BAM_VMIDMT_SMR9_ADDR A:0x67880824
y.create.l HWIO_BLSP1_BLSP_UART0_UART_DM_MR1_ADDR A:0x678af000
y.create.l HWIO_BLSP1_BLSP_UART0_UART_DM_MR2_ADDR A:0x678af004
y.create.l HWIO_BLSP1_BLSP_UART0_UART_DM_CSR_SR_DEPRECATED_ADDR A:0x678af008
y.create.l HWIO_BLSP1_BLSP_UART0_UART_DM_CR_MISR_DEPRECATED_ADDR A:0x678af010
y.create.l HWIO_BLSP1_BLSP_UART0_UART_DM_IMR_ISR_DEPRECATED_ADDR A:0x678af014
y.create.l HWIO_BLSP1_BLSP_UART0_UART_DM_IPR_ADDR A:0x678af018
y.create.l HWIO_BLSP1_BLSP_UART0_UART_DM_TFWR_ADDR A:0x678af01c
y.create.l HWIO_BLSP1_BLSP_UART0_UART_DM_RFWR_ADDR A:0x678af020
y.create.l HWIO_BLSP1_BLSP_UART0_UART_DM_HCR_ADDR A:0x678af024
y.create.l HWIO_BLSP1_BLSP_UART0_UART_DM_DMRX_ADDR A:0x678af034
y.create.l HWIO_BLSP1_BLSP_UART0_UART_DM_IRDA_RX_TOTAL_SNAP_DEPRECATED_ADDR A:0x678af038
y.create.l HWIO_BLSP1_BLSP_UART0_UART_DM_DMEN_ADDR A:0x678af03c
y.create.l HWIO_BLSP1_BLSP_UART0_UART_DM_NO_CHARS_FOR_TX_ADDR A:0x678af040
y.create.l HWIO_BLSP1_BLSP_UART0_UART_DM_BADR_ADDR A:0x678af044
y.create.l HWIO_BLSP1_BLSP_UART0_UART_DM_TESTSL_ADDR A:0x678af048
y.create.l HWIO_BLSP1_BLSP_UART0_UART_DM_TXFS_ADDR A:0x678af04c
y.create.l HWIO_BLSP1_BLSP_UART0_UART_DM_RXFS_ADDR A:0x678af050
y.create.l HWIO_BLSP1_BLSP_UART0_UART_DM_MISR_MODE_ADDR A:0x678af060
y.create.l HWIO_BLSP1_BLSP_UART0_UART_DM_MISR_RESET_ADDR A:0x678af064
y.create.l HWIO_BLSP1_BLSP_UART0_UART_DM_MISR_EXPORT_ADDR A:0x678af068
y.create.l HWIO_BLSP1_BLSP_UART0_UART_DM_MISR_VAL_ADDR A:0x678af06c
y.create.l HWIO_BLSP1_BLSP_UART0_UART_DM_TF_RF_DEPRECATED_ADDR A:0x678af070
y.create.l HWIO_BLSP1_BLSP_UART0_UART_DM_TF_RF_2_DEPRECATED_ADDR A:0x678af074
y.create.l HWIO_BLSP1_BLSP_UART0_UART_DM_TF_RF_3_DEPRECATED_ADDR A:0x678af078
y.create.l HWIO_BLSP1_BLSP_UART0_UART_DM_TF_RF_4_DEPRECATED_ADDR A:0x678af07c
y.create.l HWIO_BLSP1_BLSP_UART0_UART_DM_SIM_CFG_ADDR A:0x678af080
y.create.l HWIO_BLSP1_BLSP_UART0_UART_DM_TEST_WR_ADDR_ADDR A:0x678af084
y.create.l HWIO_BLSP1_BLSP_UART0_UART_DM_TEST_WR_DATA_ADDR A:0x678af088
y.create.l HWIO_BLSP1_BLSP_UART0_UART_DM_TEST_RD_ADDR_ADDR A:0x678af08c
y.create.l HWIO_BLSP1_BLSP_UART0_UART_DM_TEST_RD_DATA_ADDR A:0x678af090
y.create.l HWIO_BLSP1_BLSP_UART0_UART_DM_CSR_ADDR A:0x678af0a0
y.create.l HWIO_BLSP1_BLSP_UART0_UART_DM_SR_ADDR A:0x678af0a4
y.create.l HWIO_BLSP1_BLSP_UART0_UART_DM_CR_ADDR A:0x678af0a8
y.create.l HWIO_BLSP1_BLSP_UART0_UART_DM_MISR_ADDR A:0x678af0ac
y.create.l HWIO_BLSP1_BLSP_UART0_UART_DM_IMR_ADDR A:0x678af0b0
y.create.l HWIO_BLSP1_BLSP_UART0_UART_DM_ISR_ADDR A:0x678af0b4
y.create.l HWIO_BLSP1_BLSP_UART0_UART_DM_IRDA_ADDR A:0x678af0b8
y.create.l HWIO_BLSP1_BLSP_UART0_UART_DM_RX_TOTAL_SNAP_ADDR A:0x678af0bc
y.create.l HWIO_BLSP1_BLSP_UART0_UART_DM_WWT_TIMEOUT_ADDR A:0x678af0c0
y.create.l HWIO_BLSP1_BLSP_UART0_UART_DM_CLK_CTRL_ADDR A:0x678af0c4
y.create.l HWIO_BLSP1_BLSP_UART0_UART_DM_BCR_ADDR A:0x678af0c8
y.create.l HWIO_BLSP1_BLSP_UART0_UART_DM_RX_TRANS_CTRL_ADDR A:0x678af0cc
y.create.l HWIO_BLSP1_BLSP_UART0_UART_DM_DMRX_DBG_ADDR A:0x678af0d0
y.create.l HWIO_BLSP1_BLSP_UART0_UART_DM_FSM_STATUS_ADDR A:0x678af0d4
y.create.l HWIO_BLSP1_BLSP_UART0_UART_DM_HW_VERSION_ADDR A:0x678af0d8
y.create.l HWIO_BLSP1_BLSP_UART0_UART_DM_GENERICS_ADDR A:0x678af0dc
y.create.l HWIO_BLSP1_BLSP_UART0_UART_DM_ISR_CLR_ADDR A:0x678af0e0
y.create.l HWIO_BLSP1_BLSP_UART0_UART_DM_TF_ADDR A:0x678af100
y.create.l HWIO_BLSP1_BLSP_UART0_UART_DM_TF_2_ADDR A:0x678af104
y.create.l HWIO_BLSP1_BLSP_UART0_UART_DM_TF_3_ADDR A:0x678af108
y.create.l HWIO_BLSP1_BLSP_UART0_UART_DM_TF_4_ADDR A:0x678af10c
y.create.l HWIO_BLSP1_BLSP_UART0_UART_DM_TF_5_ADDR A:0x678af110
y.create.l HWIO_BLSP1_BLSP_UART0_UART_DM_TF_6_ADDR A:0x678af114
y.create.l HWIO_BLSP1_BLSP_UART0_UART_DM_TF_7_ADDR A:0x678af118
y.create.l HWIO_BLSP1_BLSP_UART0_UART_DM_TF_8_ADDR A:0x678af11c
y.create.l HWIO_BLSP1_BLSP_UART0_UART_DM_TF_9_ADDR A:0x678af120
y.create.l HWIO_BLSP1_BLSP_UART0_UART_DM_TF_10_ADDR A:0x678af124
y.create.l HWIO_BLSP1_BLSP_UART0_UART_DM_TF_11_ADDR A:0x678af128
y.create.l HWIO_BLSP1_BLSP_UART0_UART_DM_TF_12_ADDR A:0x678af12c
y.create.l HWIO_BLSP1_BLSP_UART0_UART_DM_TF_13_ADDR A:0x678af130
y.create.l HWIO_BLSP1_BLSP_UART0_UART_DM_TF_14_ADDR A:0x678af134
y.create.l HWIO_BLSP1_BLSP_UART0_UART_DM_TF_15_ADDR A:0x678af138
y.create.l HWIO_BLSP1_BLSP_UART0_UART_DM_TF_16_ADDR A:0x678af13c
y.create.l HWIO_BLSP1_BLSP_UART0_UART_DM_RF_ADDR A:0x678af140
y.create.l HWIO_BLSP1_BLSP_UART0_UART_DM_RF_2_ADDR A:0x678af144
y.create.l HWIO_BLSP1_BLSP_UART0_UART_DM_RF_3_ADDR A:0x678af148
y.create.l HWIO_BLSP1_BLSP_UART0_UART_DM_RF_4_ADDR A:0x678af14c
y.create.l HWIO_BLSP1_BLSP_UART0_UART_DM_RF_5_ADDR A:0x678af150
y.create.l HWIO_BLSP1_BLSP_UART0_UART_DM_RF_6_ADDR A:0x678af154
y.create.l HWIO_BLSP1_BLSP_UART0_UART_DM_RF_7_ADDR A:0x678af158
y.create.l HWIO_BLSP1_BLSP_UART0_UART_DM_RF_8_ADDR A:0x678af15c
y.create.l HWIO_BLSP1_BLSP_UART0_UART_DM_RF_9_ADDR A:0x678af160
y.create.l HWIO_BLSP1_BLSP_UART0_UART_DM_RF_10_ADDR A:0x678af164
y.create.l HWIO_BLSP1_BLSP_UART0_UART_DM_RF_11_ADDR A:0x678af168
y.create.l HWIO_BLSP1_BLSP_UART0_UART_DM_RF_12_ADDR A:0x678af16c
y.create.l HWIO_BLSP1_BLSP_UART0_UART_DM_RF_13_ADDR A:0x678af170
y.create.l HWIO_BLSP1_BLSP_UART0_UART_DM_RF_14_ADDR A:0x678af174
y.create.l HWIO_BLSP1_BLSP_UART0_UART_DM_RF_15_ADDR A:0x678af178
y.create.l HWIO_BLSP1_BLSP_UART0_UART_DM_RF_16_ADDR A:0x678af17c
y.create.l HWIO_BLSP1_BLSP_UART0_UART_DM_UIM_CFG_ADDR A:0x678af180
y.create.l HWIO_BLSP1_BLSP_UART0_UART_DM_UIM_CMD_ADDR A:0x678af184
y.create.l HWIO_BLSP1_BLSP_UART0_UART_DM_UIM_IO_STATUS_ADDR A:0x678af188
y.create.l HWIO_BLSP1_BLSP_UART0_UART_DM_UIM_IRQ_ISR_ADDR A:0x678af18c
y.create.l HWIO_BLSP1_BLSP_UART0_UART_DM_UIM_IRQ_MISR_ADDR A:0x678af190
y.create.l HWIO_BLSP1_BLSP_UART0_UART_DM_UIM_IRQ_CLR_ADDR A:0x678af194
y.create.l HWIO_BLSP1_BLSP_UART0_UART_DM_UIM_IRQ_IMR_ADDR A:0x678af198
y.create.l HWIO_BLSP1_BLSP_UART0_UART_DM_UIM_IRQ_IMR_SET_ADDR A:0x678af19c
y.create.l HWIO_BLSP1_BLSP_UART0_UART_DM_UIM_IRQ_IMR_CLR_ADDR A:0x678af1a0
y.create.l HWIO_BLSP1_BLSP_UART1_UART_DM_MR1_ADDR A:0x678b0000
y.create.l HWIO_BLSP1_BLSP_UART1_UART_DM_MR2_ADDR A:0x678b0004
y.create.l HWIO_BLSP1_BLSP_UART1_UART_DM_CSR_SR_DEPRECATED_ADDR A:0x678b0008
y.create.l HWIO_BLSP1_BLSP_UART1_UART_DM_CR_MISR_DEPRECATED_ADDR A:0x678b0010
y.create.l HWIO_BLSP1_BLSP_UART1_UART_DM_IMR_ISR_DEPRECATED_ADDR A:0x678b0014
y.create.l HWIO_BLSP1_BLSP_UART1_UART_DM_IPR_ADDR A:0x678b0018
y.create.l HWIO_BLSP1_BLSP_UART1_UART_DM_TFWR_ADDR A:0x678b001c
y.create.l HWIO_BLSP1_BLSP_UART1_UART_DM_RFWR_ADDR A:0x678b0020
y.create.l HWIO_BLSP1_BLSP_UART1_UART_DM_HCR_ADDR A:0x678b0024
y.create.l HWIO_BLSP1_BLSP_UART1_UART_DM_DMRX_ADDR A:0x678b0034
y.create.l HWIO_BLSP1_BLSP_UART1_UART_DM_IRDA_RX_TOTAL_SNAP_DEPRECATED_ADDR A:0x678b0038
y.create.l HWIO_BLSP1_BLSP_UART1_UART_DM_DMEN_ADDR A:0x678b003c
y.create.l HWIO_BLSP1_BLSP_UART1_UART_DM_NO_CHARS_FOR_TX_ADDR A:0x678b0040
y.create.l HWIO_BLSP1_BLSP_UART1_UART_DM_BADR_ADDR A:0x678b0044
y.create.l HWIO_BLSP1_BLSP_UART1_UART_DM_TESTSL_ADDR A:0x678b0048
y.create.l HWIO_BLSP1_BLSP_UART1_UART_DM_TXFS_ADDR A:0x678b004c
y.create.l HWIO_BLSP1_BLSP_UART1_UART_DM_RXFS_ADDR A:0x678b0050
y.create.l HWIO_BLSP1_BLSP_UART1_UART_DM_MISR_MODE_ADDR A:0x678b0060
y.create.l HWIO_BLSP1_BLSP_UART1_UART_DM_MISR_RESET_ADDR A:0x678b0064
y.create.l HWIO_BLSP1_BLSP_UART1_UART_DM_MISR_EXPORT_ADDR A:0x678b0068
y.create.l HWIO_BLSP1_BLSP_UART1_UART_DM_MISR_VAL_ADDR A:0x678b006c
y.create.l HWIO_BLSP1_BLSP_UART1_UART_DM_TF_RF_DEPRECATED_ADDR A:0x678b0070
y.create.l HWIO_BLSP1_BLSP_UART1_UART_DM_TF_RF_2_DEPRECATED_ADDR A:0x678b0074
y.create.l HWIO_BLSP1_BLSP_UART1_UART_DM_TF_RF_3_DEPRECATED_ADDR A:0x678b0078
y.create.l HWIO_BLSP1_BLSP_UART1_UART_DM_TF_RF_4_DEPRECATED_ADDR A:0x678b007c
y.create.l HWIO_BLSP1_BLSP_UART1_UART_DM_SIM_CFG_ADDR A:0x678b0080
y.create.l HWIO_BLSP1_BLSP_UART1_UART_DM_TEST_WR_ADDR_ADDR A:0x678b0084
y.create.l HWIO_BLSP1_BLSP_UART1_UART_DM_TEST_WR_DATA_ADDR A:0x678b0088
y.create.l HWIO_BLSP1_BLSP_UART1_UART_DM_TEST_RD_ADDR_ADDR A:0x678b008c
y.create.l HWIO_BLSP1_BLSP_UART1_UART_DM_TEST_RD_DATA_ADDR A:0x678b0090
y.create.l HWIO_BLSP1_BLSP_UART1_UART_DM_CSR_ADDR A:0x678b00a0
y.create.l HWIO_BLSP1_BLSP_UART1_UART_DM_SR_ADDR A:0x678b00a4
y.create.l HWIO_BLSP1_BLSP_UART1_UART_DM_CR_ADDR A:0x678b00a8
y.create.l HWIO_BLSP1_BLSP_UART1_UART_DM_MISR_ADDR A:0x678b00ac
y.create.l HWIO_BLSP1_BLSP_UART1_UART_DM_IMR_ADDR A:0x678b00b0
y.create.l HWIO_BLSP1_BLSP_UART1_UART_DM_ISR_ADDR A:0x678b00b4
y.create.l HWIO_BLSP1_BLSP_UART1_UART_DM_IRDA_ADDR A:0x678b00b8
y.create.l HWIO_BLSP1_BLSP_UART1_UART_DM_RX_TOTAL_SNAP_ADDR A:0x678b00bc
y.create.l HWIO_BLSP1_BLSP_UART1_UART_DM_WWT_TIMEOUT_ADDR A:0x678b00c0
y.create.l HWIO_BLSP1_BLSP_UART1_UART_DM_CLK_CTRL_ADDR A:0x678b00c4
y.create.l HWIO_BLSP1_BLSP_UART1_UART_DM_BCR_ADDR A:0x678b00c8
y.create.l HWIO_BLSP1_BLSP_UART1_UART_DM_RX_TRANS_CTRL_ADDR A:0x678b00cc
y.create.l HWIO_BLSP1_BLSP_UART1_UART_DM_DMRX_DBG_ADDR A:0x678b00d0
y.create.l HWIO_BLSP1_BLSP_UART1_UART_DM_FSM_STATUS_ADDR A:0x678b00d4
y.create.l HWIO_BLSP1_BLSP_UART1_UART_DM_HW_VERSION_ADDR A:0x678b00d8
y.create.l HWIO_BLSP1_BLSP_UART1_UART_DM_GENERICS_ADDR A:0x678b00dc
y.create.l HWIO_BLSP1_BLSP_UART1_UART_DM_ISR_CLR_ADDR A:0x678b00e0
y.create.l HWIO_BLSP1_BLSP_UART1_UART_DM_TF_ADDR A:0x678b0100
y.create.l HWIO_BLSP1_BLSP_UART1_UART_DM_TF_2_ADDR A:0x678b0104
y.create.l HWIO_BLSP1_BLSP_UART1_UART_DM_TF_3_ADDR A:0x678b0108
y.create.l HWIO_BLSP1_BLSP_UART1_UART_DM_TF_4_ADDR A:0x678b010c
y.create.l HWIO_BLSP1_BLSP_UART1_UART_DM_TF_5_ADDR A:0x678b0110
y.create.l HWIO_BLSP1_BLSP_UART1_UART_DM_TF_6_ADDR A:0x678b0114
y.create.l HWIO_BLSP1_BLSP_UART1_UART_DM_TF_7_ADDR A:0x678b0118
y.create.l HWIO_BLSP1_BLSP_UART1_UART_DM_TF_8_ADDR A:0x678b011c
y.create.l HWIO_BLSP1_BLSP_UART1_UART_DM_TF_9_ADDR A:0x678b0120
y.create.l HWIO_BLSP1_BLSP_UART1_UART_DM_TF_10_ADDR A:0x678b0124
y.create.l HWIO_BLSP1_BLSP_UART1_UART_DM_TF_11_ADDR A:0x678b0128
y.create.l HWIO_BLSP1_BLSP_UART1_UART_DM_TF_12_ADDR A:0x678b012c
y.create.l HWIO_BLSP1_BLSP_UART1_UART_DM_TF_13_ADDR A:0x678b0130
y.create.l HWIO_BLSP1_BLSP_UART1_UART_DM_TF_14_ADDR A:0x678b0134
y.create.l HWIO_BLSP1_BLSP_UART1_UART_DM_TF_15_ADDR A:0x678b0138
y.create.l HWIO_BLSP1_BLSP_UART1_UART_DM_TF_16_ADDR A:0x678b013c
y.create.l HWIO_BLSP1_BLSP_UART1_UART_DM_RF_ADDR A:0x678b0140
y.create.l HWIO_BLSP1_BLSP_UART1_UART_DM_RF_2_ADDR A:0x678b0144
y.create.l HWIO_BLSP1_BLSP_UART1_UART_DM_RF_3_ADDR A:0x678b0148
y.create.l HWIO_BLSP1_BLSP_UART1_UART_DM_RF_4_ADDR A:0x678b014c
y.create.l HWIO_BLSP1_BLSP_UART1_UART_DM_RF_5_ADDR A:0x678b0150
y.create.l HWIO_BLSP1_BLSP_UART1_UART_DM_RF_6_ADDR A:0x678b0154
y.create.l HWIO_BLSP1_BLSP_UART1_UART_DM_RF_7_ADDR A:0x678b0158
y.create.l HWIO_BLSP1_BLSP_UART1_UART_DM_RF_8_ADDR A:0x678b015c
y.create.l HWIO_BLSP1_BLSP_UART1_UART_DM_RF_9_ADDR A:0x678b0160
y.create.l HWIO_BLSP1_BLSP_UART1_UART_DM_RF_10_ADDR A:0x678b0164
y.create.l HWIO_BLSP1_BLSP_UART1_UART_DM_RF_11_ADDR A:0x678b0168
y.create.l HWIO_BLSP1_BLSP_UART1_UART_DM_RF_12_ADDR A:0x678b016c
y.create.l HWIO_BLSP1_BLSP_UART1_UART_DM_RF_13_ADDR A:0x678b0170
y.create.l HWIO_BLSP1_BLSP_UART1_UART_DM_RF_14_ADDR A:0x678b0174
y.create.l HWIO_BLSP1_BLSP_UART1_UART_DM_RF_15_ADDR A:0x678b0178
y.create.l HWIO_BLSP1_BLSP_UART1_UART_DM_RF_16_ADDR A:0x678b017c
y.create.l HWIO_BLSP1_BLSP_UART1_UART_DM_UIM_CFG_ADDR A:0x678b0180
y.create.l HWIO_BLSP1_BLSP_UART1_UART_DM_UIM_CMD_ADDR A:0x678b0184
y.create.l HWIO_BLSP1_BLSP_UART1_UART_DM_UIM_IO_STATUS_ADDR A:0x678b0188
y.create.l HWIO_BLSP1_BLSP_UART1_UART_DM_UIM_IRQ_ISR_ADDR A:0x678b018c
y.create.l HWIO_BLSP1_BLSP_UART1_UART_DM_UIM_IRQ_MISR_ADDR A:0x678b0190
y.create.l HWIO_BLSP1_BLSP_UART1_UART_DM_UIM_IRQ_CLR_ADDR A:0x678b0194
y.create.l HWIO_BLSP1_BLSP_UART1_UART_DM_UIM_IRQ_IMR_ADDR A:0x678b0198
y.create.l HWIO_BLSP1_BLSP_UART1_UART_DM_UIM_IRQ_IMR_SET_ADDR A:0x678b019c
y.create.l HWIO_BLSP1_BLSP_UART1_UART_DM_UIM_IRQ_IMR_CLR_ADDR A:0x678b01a0
y.create.l HWIO_BLSP1_BLSP_UART2_UART_DM_MR1_ADDR A:0x678b1000
y.create.l HWIO_BLSP1_BLSP_UART2_UART_DM_MR2_ADDR A:0x678b1004
y.create.l HWIO_BLSP1_BLSP_UART2_UART_DM_CSR_SR_DEPRECATED_ADDR A:0x678b1008
y.create.l HWIO_BLSP1_BLSP_UART2_UART_DM_CR_MISR_DEPRECATED_ADDR A:0x678b1010
y.create.l HWIO_BLSP1_BLSP_UART2_UART_DM_IMR_ISR_DEPRECATED_ADDR A:0x678b1014
y.create.l HWIO_BLSP1_BLSP_UART2_UART_DM_IPR_ADDR A:0x678b1018
y.create.l HWIO_BLSP1_BLSP_UART2_UART_DM_TFWR_ADDR A:0x678b101c
y.create.l HWIO_BLSP1_BLSP_UART2_UART_DM_RFWR_ADDR A:0x678b1020
y.create.l HWIO_BLSP1_BLSP_UART2_UART_DM_HCR_ADDR A:0x678b1024
y.create.l HWIO_BLSP1_BLSP_UART2_UART_DM_DMRX_ADDR A:0x678b1034
y.create.l HWIO_BLSP1_BLSP_UART2_UART_DM_IRDA_RX_TOTAL_SNAP_DEPRECATED_ADDR A:0x678b1038
y.create.l HWIO_BLSP1_BLSP_UART2_UART_DM_DMEN_ADDR A:0x678b103c
y.create.l HWIO_BLSP1_BLSP_UART2_UART_DM_NO_CHARS_FOR_TX_ADDR A:0x678b1040
y.create.l HWIO_BLSP1_BLSP_UART2_UART_DM_BADR_ADDR A:0x678b1044
y.create.l HWIO_BLSP1_BLSP_UART2_UART_DM_TESTSL_ADDR A:0x678b1048
y.create.l HWIO_BLSP1_BLSP_UART2_UART_DM_TXFS_ADDR A:0x678b104c
y.create.l HWIO_BLSP1_BLSP_UART2_UART_DM_RXFS_ADDR A:0x678b1050
y.create.l HWIO_BLSP1_BLSP_UART2_UART_DM_MISR_MODE_ADDR A:0x678b1060
y.create.l HWIO_BLSP1_BLSP_UART2_UART_DM_MISR_RESET_ADDR A:0x678b1064
y.create.l HWIO_BLSP1_BLSP_UART2_UART_DM_MISR_EXPORT_ADDR A:0x678b1068
y.create.l HWIO_BLSP1_BLSP_UART2_UART_DM_MISR_VAL_ADDR A:0x678b106c
y.create.l HWIO_BLSP1_BLSP_UART2_UART_DM_TF_RF_DEPRECATED_ADDR A:0x678b1070
y.create.l HWIO_BLSP1_BLSP_UART2_UART_DM_TF_RF_2_DEPRECATED_ADDR A:0x678b1074
y.create.l HWIO_BLSP1_BLSP_UART2_UART_DM_TF_RF_3_DEPRECATED_ADDR A:0x678b1078
y.create.l HWIO_BLSP1_BLSP_UART2_UART_DM_TF_RF_4_DEPRECATED_ADDR A:0x678b107c
y.create.l HWIO_BLSP1_BLSP_UART2_UART_DM_SIM_CFG_ADDR A:0x678b1080
y.create.l HWIO_BLSP1_BLSP_UART2_UART_DM_TEST_WR_ADDR_ADDR A:0x678b1084
y.create.l HWIO_BLSP1_BLSP_UART2_UART_DM_TEST_WR_DATA_ADDR A:0x678b1088
y.create.l HWIO_BLSP1_BLSP_UART2_UART_DM_TEST_RD_ADDR_ADDR A:0x678b108c
y.create.l HWIO_BLSP1_BLSP_UART2_UART_DM_TEST_RD_DATA_ADDR A:0x678b1090
y.create.l HWIO_BLSP1_BLSP_UART2_UART_DM_CSR_ADDR A:0x678b10a0
y.create.l HWIO_BLSP1_BLSP_UART2_UART_DM_SR_ADDR A:0x678b10a4
y.create.l HWIO_BLSP1_BLSP_UART2_UART_DM_CR_ADDR A:0x678b10a8
y.create.l HWIO_BLSP1_BLSP_UART2_UART_DM_MISR_ADDR A:0x678b10ac
y.create.l HWIO_BLSP1_BLSP_UART2_UART_DM_IMR_ADDR A:0x678b10b0
y.create.l HWIO_BLSP1_BLSP_UART2_UART_DM_ISR_ADDR A:0x678b10b4
y.create.l HWIO_BLSP1_BLSP_UART2_UART_DM_IRDA_ADDR A:0x678b10b8
y.create.l HWIO_BLSP1_BLSP_UART2_UART_DM_RX_TOTAL_SNAP_ADDR A:0x678b10bc
y.create.l HWIO_BLSP1_BLSP_UART2_UART_DM_WWT_TIMEOUT_ADDR A:0x678b10c0
y.create.l HWIO_BLSP1_BLSP_UART2_UART_DM_CLK_CTRL_ADDR A:0x678b10c4
y.create.l HWIO_BLSP1_BLSP_UART2_UART_DM_BCR_ADDR A:0x678b10c8
y.create.l HWIO_BLSP1_BLSP_UART2_UART_DM_RX_TRANS_CTRL_ADDR A:0x678b10cc
y.create.l HWIO_BLSP1_BLSP_UART2_UART_DM_DMRX_DBG_ADDR A:0x678b10d0
y.create.l HWIO_BLSP1_BLSP_UART2_UART_DM_FSM_STATUS_ADDR A:0x678b10d4
y.create.l HWIO_BLSP1_BLSP_UART2_UART_DM_HW_VERSION_ADDR A:0x678b10d8
y.create.l HWIO_BLSP1_BLSP_UART2_UART_DM_GENERICS_ADDR A:0x678b10dc
y.create.l HWIO_BLSP1_BLSP_UART2_UART_DM_ISR_CLR_ADDR A:0x678b10e0
y.create.l HWIO_BLSP1_BLSP_UART2_UART_DM_TF_ADDR A:0x678b1100
y.create.l HWIO_BLSP1_BLSP_UART2_UART_DM_TF_2_ADDR A:0x678b1104
y.create.l HWIO_BLSP1_BLSP_UART2_UART_DM_TF_3_ADDR A:0x678b1108
y.create.l HWIO_BLSP1_BLSP_UART2_UART_DM_TF_4_ADDR A:0x678b110c
y.create.l HWIO_BLSP1_BLSP_UART2_UART_DM_TF_5_ADDR A:0x678b1110
y.create.l HWIO_BLSP1_BLSP_UART2_UART_DM_TF_6_ADDR A:0x678b1114
y.create.l HWIO_BLSP1_BLSP_UART2_UART_DM_TF_7_ADDR A:0x678b1118
y.create.l HWIO_BLSP1_BLSP_UART2_UART_DM_TF_8_ADDR A:0x678b111c
y.create.l HWIO_BLSP1_BLSP_UART2_UART_DM_TF_9_ADDR A:0x678b1120
y.create.l HWIO_BLSP1_BLSP_UART2_UART_DM_TF_10_ADDR A:0x678b1124
y.create.l HWIO_BLSP1_BLSP_UART2_UART_DM_TF_11_ADDR A:0x678b1128
y.create.l HWIO_BLSP1_BLSP_UART2_UART_DM_TF_12_ADDR A:0x678b112c
y.create.l HWIO_BLSP1_BLSP_UART2_UART_DM_TF_13_ADDR A:0x678b1130
y.create.l HWIO_BLSP1_BLSP_UART2_UART_DM_TF_14_ADDR A:0x678b1134
y.create.l HWIO_BLSP1_BLSP_UART2_UART_DM_TF_15_ADDR A:0x678b1138
y.create.l HWIO_BLSP1_BLSP_UART2_UART_DM_TF_16_ADDR A:0x678b113c
y.create.l HWIO_BLSP1_BLSP_UART2_UART_DM_RF_ADDR A:0x678b1140
y.create.l HWIO_BLSP1_BLSP_UART2_UART_DM_RF_2_ADDR A:0x678b1144
y.create.l HWIO_BLSP1_BLSP_UART2_UART_DM_RF_3_ADDR A:0x678b1148
y.create.l HWIO_BLSP1_BLSP_UART2_UART_DM_RF_4_ADDR A:0x678b114c
y.create.l HWIO_BLSP1_BLSP_UART2_UART_DM_RF_5_ADDR A:0x678b1150
y.create.l HWIO_BLSP1_BLSP_UART2_UART_DM_RF_6_ADDR A:0x678b1154
y.create.l HWIO_BLSP1_BLSP_UART2_UART_DM_RF_7_ADDR A:0x678b1158
y.create.l HWIO_BLSP1_BLSP_UART2_UART_DM_RF_8_ADDR A:0x678b115c
y.create.l HWIO_BLSP1_BLSP_UART2_UART_DM_RF_9_ADDR A:0x678b1160
y.create.l HWIO_BLSP1_BLSP_UART2_UART_DM_RF_10_ADDR A:0x678b1164
y.create.l HWIO_BLSP1_BLSP_UART2_UART_DM_RF_11_ADDR A:0x678b1168
y.create.l HWIO_BLSP1_BLSP_UART2_UART_DM_RF_12_ADDR A:0x678b116c
y.create.l HWIO_BLSP1_BLSP_UART2_UART_DM_RF_13_ADDR A:0x678b1170
y.create.l HWIO_BLSP1_BLSP_UART2_UART_DM_RF_14_ADDR A:0x678b1174
y.create.l HWIO_BLSP1_BLSP_UART2_UART_DM_RF_15_ADDR A:0x678b1178
y.create.l HWIO_BLSP1_BLSP_UART2_UART_DM_RF_16_ADDR A:0x678b117c
y.create.l HWIO_BLSP1_BLSP_UART2_UART_DM_UIM_CFG_ADDR A:0x678b1180
y.create.l HWIO_BLSP1_BLSP_UART2_UART_DM_UIM_CMD_ADDR A:0x678b1184
y.create.l HWIO_BLSP1_BLSP_UART2_UART_DM_UIM_IO_STATUS_ADDR A:0x678b1188
y.create.l HWIO_BLSP1_BLSP_UART2_UART_DM_UIM_IRQ_ISR_ADDR A:0x678b118c
y.create.l HWIO_BLSP1_BLSP_UART2_UART_DM_UIM_IRQ_MISR_ADDR A:0x678b1190
y.create.l HWIO_BLSP1_BLSP_UART2_UART_DM_UIM_IRQ_CLR_ADDR A:0x678b1194
y.create.l HWIO_BLSP1_BLSP_UART2_UART_DM_UIM_IRQ_IMR_ADDR A:0x678b1198
y.create.l HWIO_BLSP1_BLSP_UART2_UART_DM_UIM_IRQ_IMR_SET_ADDR A:0x678b119c
y.create.l HWIO_BLSP1_BLSP_UART2_UART_DM_UIM_IRQ_IMR_CLR_ADDR A:0x678b11a0
y.create.l HWIO_BLSP1_BLSP_UART3_UART_DM_MR1_ADDR A:0x678b2000
y.create.l HWIO_BLSP1_BLSP_UART3_UART_DM_MR2_ADDR A:0x678b2004
y.create.l HWIO_BLSP1_BLSP_UART3_UART_DM_CSR_SR_DEPRECATED_ADDR A:0x678b2008
y.create.l HWIO_BLSP1_BLSP_UART3_UART_DM_CR_MISR_DEPRECATED_ADDR A:0x678b2010
y.create.l HWIO_BLSP1_BLSP_UART3_UART_DM_IMR_ISR_DEPRECATED_ADDR A:0x678b2014
y.create.l HWIO_BLSP1_BLSP_UART3_UART_DM_IPR_ADDR A:0x678b2018
y.create.l HWIO_BLSP1_BLSP_UART3_UART_DM_TFWR_ADDR A:0x678b201c
y.create.l HWIO_BLSP1_BLSP_UART3_UART_DM_RFWR_ADDR A:0x678b2020
y.create.l HWIO_BLSP1_BLSP_UART3_UART_DM_HCR_ADDR A:0x678b2024
y.create.l HWIO_BLSP1_BLSP_UART3_UART_DM_DMRX_ADDR A:0x678b2034
y.create.l HWIO_BLSP1_BLSP_UART3_UART_DM_IRDA_RX_TOTAL_SNAP_DEPRECATED_ADDR A:0x678b2038
y.create.l HWIO_BLSP1_BLSP_UART3_UART_DM_DMEN_ADDR A:0x678b203c
y.create.l HWIO_BLSP1_BLSP_UART3_UART_DM_NO_CHARS_FOR_TX_ADDR A:0x678b2040
y.create.l HWIO_BLSP1_BLSP_UART3_UART_DM_BADR_ADDR A:0x678b2044
y.create.l HWIO_BLSP1_BLSP_UART3_UART_DM_TESTSL_ADDR A:0x678b2048
y.create.l HWIO_BLSP1_BLSP_UART3_UART_DM_TXFS_ADDR A:0x678b204c
y.create.l HWIO_BLSP1_BLSP_UART3_UART_DM_RXFS_ADDR A:0x678b2050
y.create.l HWIO_BLSP1_BLSP_UART3_UART_DM_MISR_MODE_ADDR A:0x678b2060
y.create.l HWIO_BLSP1_BLSP_UART3_UART_DM_MISR_RESET_ADDR A:0x678b2064
y.create.l HWIO_BLSP1_BLSP_UART3_UART_DM_MISR_EXPORT_ADDR A:0x678b2068
y.create.l HWIO_BLSP1_BLSP_UART3_UART_DM_MISR_VAL_ADDR A:0x678b206c
y.create.l HWIO_BLSP1_BLSP_UART3_UART_DM_TF_RF_DEPRECATED_ADDR A:0x678b2070
y.create.l HWIO_BLSP1_BLSP_UART3_UART_DM_TF_RF_2_DEPRECATED_ADDR A:0x678b2074
y.create.l HWIO_BLSP1_BLSP_UART3_UART_DM_TF_RF_3_DEPRECATED_ADDR A:0x678b2078
y.create.l HWIO_BLSP1_BLSP_UART3_UART_DM_TF_RF_4_DEPRECATED_ADDR A:0x678b207c
y.create.l HWIO_BLSP1_BLSP_UART3_UART_DM_SIM_CFG_ADDR A:0x678b2080
y.create.l HWIO_BLSP1_BLSP_UART3_UART_DM_TEST_WR_ADDR_ADDR A:0x678b2084
y.create.l HWIO_BLSP1_BLSP_UART3_UART_DM_TEST_WR_DATA_ADDR A:0x678b2088
y.create.l HWIO_BLSP1_BLSP_UART3_UART_DM_TEST_RD_ADDR_ADDR A:0x678b208c
y.create.l HWIO_BLSP1_BLSP_UART3_UART_DM_TEST_RD_DATA_ADDR A:0x678b2090
y.create.l HWIO_BLSP1_BLSP_UART3_UART_DM_CSR_ADDR A:0x678b20a0
y.create.l HWIO_BLSP1_BLSP_UART3_UART_DM_SR_ADDR A:0x678b20a4
y.create.l HWIO_BLSP1_BLSP_UART3_UART_DM_CR_ADDR A:0x678b20a8
y.create.l HWIO_BLSP1_BLSP_UART3_UART_DM_MISR_ADDR A:0x678b20ac
y.create.l HWIO_BLSP1_BLSP_UART3_UART_DM_IMR_ADDR A:0x678b20b0
y.create.l HWIO_BLSP1_BLSP_UART3_UART_DM_ISR_ADDR A:0x678b20b4
y.create.l HWIO_BLSP1_BLSP_UART3_UART_DM_IRDA_ADDR A:0x678b20b8
y.create.l HWIO_BLSP1_BLSP_UART3_UART_DM_RX_TOTAL_SNAP_ADDR A:0x678b20bc
y.create.l HWIO_BLSP1_BLSP_UART3_UART_DM_WWT_TIMEOUT_ADDR A:0x678b20c0
y.create.l HWIO_BLSP1_BLSP_UART3_UART_DM_CLK_CTRL_ADDR A:0x678b20c4
y.create.l HWIO_BLSP1_BLSP_UART3_UART_DM_BCR_ADDR A:0x678b20c8
y.create.l HWIO_BLSP1_BLSP_UART3_UART_DM_RX_TRANS_CTRL_ADDR A:0x678b20cc
y.create.l HWIO_BLSP1_BLSP_UART3_UART_DM_DMRX_DBG_ADDR A:0x678b20d0
y.create.l HWIO_BLSP1_BLSP_UART3_UART_DM_FSM_STATUS_ADDR A:0x678b20d4
y.create.l HWIO_BLSP1_BLSP_UART3_UART_DM_HW_VERSION_ADDR A:0x678b20d8
y.create.l HWIO_BLSP1_BLSP_UART3_UART_DM_GENERICS_ADDR A:0x678b20dc
y.create.l HWIO_BLSP1_BLSP_UART3_UART_DM_ISR_CLR_ADDR A:0x678b20e0
y.create.l HWIO_BLSP1_BLSP_UART3_UART_DM_TF_ADDR A:0x678b2100
y.create.l HWIO_BLSP1_BLSP_UART3_UART_DM_TF_2_ADDR A:0x678b2104
y.create.l HWIO_BLSP1_BLSP_UART3_UART_DM_TF_3_ADDR A:0x678b2108
y.create.l HWIO_BLSP1_BLSP_UART3_UART_DM_TF_4_ADDR A:0x678b210c
y.create.l HWIO_BLSP1_BLSP_UART3_UART_DM_TF_5_ADDR A:0x678b2110
y.create.l HWIO_BLSP1_BLSP_UART3_UART_DM_TF_6_ADDR A:0x678b2114
y.create.l HWIO_BLSP1_BLSP_UART3_UART_DM_TF_7_ADDR A:0x678b2118
y.create.l HWIO_BLSP1_BLSP_UART3_UART_DM_TF_8_ADDR A:0x678b211c
y.create.l HWIO_BLSP1_BLSP_UART3_UART_DM_TF_9_ADDR A:0x678b2120
y.create.l HWIO_BLSP1_BLSP_UART3_UART_DM_TF_10_ADDR A:0x678b2124
y.create.l HWIO_BLSP1_BLSP_UART3_UART_DM_TF_11_ADDR A:0x678b2128
y.create.l HWIO_BLSP1_BLSP_UART3_UART_DM_TF_12_ADDR A:0x678b212c
y.create.l HWIO_BLSP1_BLSP_UART3_UART_DM_TF_13_ADDR A:0x678b2130
y.create.l HWIO_BLSP1_BLSP_UART3_UART_DM_TF_14_ADDR A:0x678b2134
y.create.l HWIO_BLSP1_BLSP_UART3_UART_DM_TF_15_ADDR A:0x678b2138
y.create.l HWIO_BLSP1_BLSP_UART3_UART_DM_TF_16_ADDR A:0x678b213c
y.create.l HWIO_BLSP1_BLSP_UART3_UART_DM_RF_ADDR A:0x678b2140
y.create.l HWIO_BLSP1_BLSP_UART3_UART_DM_RF_2_ADDR A:0x678b2144
y.create.l HWIO_BLSP1_BLSP_UART3_UART_DM_RF_3_ADDR A:0x678b2148
y.create.l HWIO_BLSP1_BLSP_UART3_UART_DM_RF_4_ADDR A:0x678b214c
y.create.l HWIO_BLSP1_BLSP_UART3_UART_DM_RF_5_ADDR A:0x678b2150
y.create.l HWIO_BLSP1_BLSP_UART3_UART_DM_RF_6_ADDR A:0x678b2154
y.create.l HWIO_BLSP1_BLSP_UART3_UART_DM_RF_7_ADDR A:0x678b2158
y.create.l HWIO_BLSP1_BLSP_UART3_UART_DM_RF_8_ADDR A:0x678b215c
y.create.l HWIO_BLSP1_BLSP_UART3_UART_DM_RF_9_ADDR A:0x678b2160
y.create.l HWIO_BLSP1_BLSP_UART3_UART_DM_RF_10_ADDR A:0x678b2164
y.create.l HWIO_BLSP1_BLSP_UART3_UART_DM_RF_11_ADDR A:0x678b2168
y.create.l HWIO_BLSP1_BLSP_UART3_UART_DM_RF_12_ADDR A:0x678b216c
y.create.l HWIO_BLSP1_BLSP_UART3_UART_DM_RF_13_ADDR A:0x678b2170
y.create.l HWIO_BLSP1_BLSP_UART3_UART_DM_RF_14_ADDR A:0x678b2174
y.create.l HWIO_BLSP1_BLSP_UART3_UART_DM_RF_15_ADDR A:0x678b2178
y.create.l HWIO_BLSP1_BLSP_UART3_UART_DM_RF_16_ADDR A:0x678b217c
y.create.l HWIO_BLSP1_BLSP_UART3_UART_DM_UIM_CFG_ADDR A:0x678b2180
y.create.l HWIO_BLSP1_BLSP_UART3_UART_DM_UIM_CMD_ADDR A:0x678b2184
y.create.l HWIO_BLSP1_BLSP_UART3_UART_DM_UIM_IO_STATUS_ADDR A:0x678b2188
y.create.l HWIO_BLSP1_BLSP_UART3_UART_DM_UIM_IRQ_ISR_ADDR A:0x678b218c
y.create.l HWIO_BLSP1_BLSP_UART3_UART_DM_UIM_IRQ_MISR_ADDR A:0x678b2190
y.create.l HWIO_BLSP1_BLSP_UART3_UART_DM_UIM_IRQ_CLR_ADDR A:0x678b2194
y.create.l HWIO_BLSP1_BLSP_UART3_UART_DM_UIM_IRQ_IMR_ADDR A:0x678b2198
y.create.l HWIO_BLSP1_BLSP_UART3_UART_DM_UIM_IRQ_IMR_SET_ADDR A:0x678b219c
y.create.l HWIO_BLSP1_BLSP_UART3_UART_DM_UIM_IRQ_IMR_CLR_ADDR A:0x678b21a0
y.create.l HWIO_BLSP1_BLSP_UART4_UART_DM_MR1_ADDR A:0x678b3000
y.create.l HWIO_BLSP1_BLSP_UART4_UART_DM_MR2_ADDR A:0x678b3004
y.create.l HWIO_BLSP1_BLSP_UART4_UART_DM_CSR_SR_DEPRECATED_ADDR A:0x678b3008
y.create.l HWIO_BLSP1_BLSP_UART4_UART_DM_CR_MISR_DEPRECATED_ADDR A:0x678b3010
y.create.l HWIO_BLSP1_BLSP_UART4_UART_DM_IMR_ISR_DEPRECATED_ADDR A:0x678b3014
y.create.l HWIO_BLSP1_BLSP_UART4_UART_DM_IPR_ADDR A:0x678b3018
y.create.l HWIO_BLSP1_BLSP_UART4_UART_DM_TFWR_ADDR A:0x678b301c
y.create.l HWIO_BLSP1_BLSP_UART4_UART_DM_RFWR_ADDR A:0x678b3020
y.create.l HWIO_BLSP1_BLSP_UART4_UART_DM_HCR_ADDR A:0x678b3024
y.create.l HWIO_BLSP1_BLSP_UART4_UART_DM_DMRX_ADDR A:0x678b3034
y.create.l HWIO_BLSP1_BLSP_UART4_UART_DM_IRDA_RX_TOTAL_SNAP_DEPRECATED_ADDR A:0x678b3038
y.create.l HWIO_BLSP1_BLSP_UART4_UART_DM_DMEN_ADDR A:0x678b303c
y.create.l HWIO_BLSP1_BLSP_UART4_UART_DM_NO_CHARS_FOR_TX_ADDR A:0x678b3040
y.create.l HWIO_BLSP1_BLSP_UART4_UART_DM_BADR_ADDR A:0x678b3044
y.create.l HWIO_BLSP1_BLSP_UART4_UART_DM_TESTSL_ADDR A:0x678b3048
y.create.l HWIO_BLSP1_BLSP_UART4_UART_DM_TXFS_ADDR A:0x678b304c
y.create.l HWIO_BLSP1_BLSP_UART4_UART_DM_RXFS_ADDR A:0x678b3050
y.create.l HWIO_BLSP1_BLSP_UART4_UART_DM_MISR_MODE_ADDR A:0x678b3060
y.create.l HWIO_BLSP1_BLSP_UART4_UART_DM_MISR_RESET_ADDR A:0x678b3064
y.create.l HWIO_BLSP1_BLSP_UART4_UART_DM_MISR_EXPORT_ADDR A:0x678b3068
y.create.l HWIO_BLSP1_BLSP_UART4_UART_DM_MISR_VAL_ADDR A:0x678b306c
y.create.l HWIO_BLSP1_BLSP_UART4_UART_DM_TF_RF_DEPRECATED_ADDR A:0x678b3070
y.create.l HWIO_BLSP1_BLSP_UART4_UART_DM_TF_RF_2_DEPRECATED_ADDR A:0x678b3074
y.create.l HWIO_BLSP1_BLSP_UART4_UART_DM_TF_RF_3_DEPRECATED_ADDR A:0x678b3078
y.create.l HWIO_BLSP1_BLSP_UART4_UART_DM_TF_RF_4_DEPRECATED_ADDR A:0x678b307c
y.create.l HWIO_BLSP1_BLSP_UART4_UART_DM_SIM_CFG_ADDR A:0x678b3080
y.create.l HWIO_BLSP1_BLSP_UART4_UART_DM_TEST_WR_ADDR_ADDR A:0x678b3084
y.create.l HWIO_BLSP1_BLSP_UART4_UART_DM_TEST_WR_DATA_ADDR A:0x678b3088
y.create.l HWIO_BLSP1_BLSP_UART4_UART_DM_TEST_RD_ADDR_ADDR A:0x678b308c
y.create.l HWIO_BLSP1_BLSP_UART4_UART_DM_TEST_RD_DATA_ADDR A:0x678b3090
y.create.l HWIO_BLSP1_BLSP_UART4_UART_DM_CSR_ADDR A:0x678b30a0
y.create.l HWIO_BLSP1_BLSP_UART4_UART_DM_SR_ADDR A:0x678b30a4
y.create.l HWIO_BLSP1_BLSP_UART4_UART_DM_CR_ADDR A:0x678b30a8
y.create.l HWIO_BLSP1_BLSP_UART4_UART_DM_MISR_ADDR A:0x678b30ac
y.create.l HWIO_BLSP1_BLSP_UART4_UART_DM_IMR_ADDR A:0x678b30b0
y.create.l HWIO_BLSP1_BLSP_UART4_UART_DM_ISR_ADDR A:0x678b30b4
y.create.l HWIO_BLSP1_BLSP_UART4_UART_DM_IRDA_ADDR A:0x678b30b8
y.create.l HWIO_BLSP1_BLSP_UART4_UART_DM_RX_TOTAL_SNAP_ADDR A:0x678b30bc
y.create.l HWIO_BLSP1_BLSP_UART4_UART_DM_WWT_TIMEOUT_ADDR A:0x678b30c0
y.create.l HWIO_BLSP1_BLSP_UART4_UART_DM_CLK_CTRL_ADDR A:0x678b30c4
y.create.l HWIO_BLSP1_BLSP_UART4_UART_DM_BCR_ADDR A:0x678b30c8
y.create.l HWIO_BLSP1_BLSP_UART4_UART_DM_RX_TRANS_CTRL_ADDR A:0x678b30cc
y.create.l HWIO_BLSP1_BLSP_UART4_UART_DM_DMRX_DBG_ADDR A:0x678b30d0
y.create.l HWIO_BLSP1_BLSP_UART4_UART_DM_FSM_STATUS_ADDR A:0x678b30d4
y.create.l HWIO_BLSP1_BLSP_UART4_UART_DM_HW_VERSION_ADDR A:0x678b30d8
y.create.l HWIO_BLSP1_BLSP_UART4_UART_DM_GENERICS_ADDR A:0x678b30dc
y.create.l HWIO_BLSP1_BLSP_UART4_UART_DM_ISR_CLR_ADDR A:0x678b30e0
y.create.l HWIO_BLSP1_BLSP_UART4_UART_DM_TF_ADDR A:0x678b3100
y.create.l HWIO_BLSP1_BLSP_UART4_UART_DM_TF_2_ADDR A:0x678b3104
y.create.l HWIO_BLSP1_BLSP_UART4_UART_DM_TF_3_ADDR A:0x678b3108
y.create.l HWIO_BLSP1_BLSP_UART4_UART_DM_TF_4_ADDR A:0x678b310c
y.create.l HWIO_BLSP1_BLSP_UART4_UART_DM_TF_5_ADDR A:0x678b3110
y.create.l HWIO_BLSP1_BLSP_UART4_UART_DM_TF_6_ADDR A:0x678b3114
y.create.l HWIO_BLSP1_BLSP_UART4_UART_DM_TF_7_ADDR A:0x678b3118
y.create.l HWIO_BLSP1_BLSP_UART4_UART_DM_TF_8_ADDR A:0x678b311c
y.create.l HWIO_BLSP1_BLSP_UART4_UART_DM_TF_9_ADDR A:0x678b3120
y.create.l HWIO_BLSP1_BLSP_UART4_UART_DM_TF_10_ADDR A:0x678b3124
y.create.l HWIO_BLSP1_BLSP_UART4_UART_DM_TF_11_ADDR A:0x678b3128
y.create.l HWIO_BLSP1_BLSP_UART4_UART_DM_TF_12_ADDR A:0x678b312c
y.create.l HWIO_BLSP1_BLSP_UART4_UART_DM_TF_13_ADDR A:0x678b3130
y.create.l HWIO_BLSP1_BLSP_UART4_UART_DM_TF_14_ADDR A:0x678b3134
y.create.l HWIO_BLSP1_BLSP_UART4_UART_DM_TF_15_ADDR A:0x678b3138
y.create.l HWIO_BLSP1_BLSP_UART4_UART_DM_TF_16_ADDR A:0x678b313c
y.create.l HWIO_BLSP1_BLSP_UART4_UART_DM_RF_ADDR A:0x678b3140
y.create.l HWIO_BLSP1_BLSP_UART4_UART_DM_RF_2_ADDR A:0x678b3144
y.create.l HWIO_BLSP1_BLSP_UART4_UART_DM_RF_3_ADDR A:0x678b3148
y.create.l HWIO_BLSP1_BLSP_UART4_UART_DM_RF_4_ADDR A:0x678b314c
y.create.l HWIO_BLSP1_BLSP_UART4_UART_DM_RF_5_ADDR A:0x678b3150
y.create.l HWIO_BLSP1_BLSP_UART4_UART_DM_RF_6_ADDR A:0x678b3154
y.create.l HWIO_BLSP1_BLSP_UART4_UART_DM_RF_7_ADDR A:0x678b3158
y.create.l HWIO_BLSP1_BLSP_UART4_UART_DM_RF_8_ADDR A:0x678b315c
y.create.l HWIO_BLSP1_BLSP_UART4_UART_DM_RF_9_ADDR A:0x678b3160
y.create.l HWIO_BLSP1_BLSP_UART4_UART_DM_RF_10_ADDR A:0x678b3164
y.create.l HWIO_BLSP1_BLSP_UART4_UART_DM_RF_11_ADDR A:0x678b3168
y.create.l HWIO_BLSP1_BLSP_UART4_UART_DM_RF_12_ADDR A:0x678b316c
y.create.l HWIO_BLSP1_BLSP_UART4_UART_DM_RF_13_ADDR A:0x678b3170
y.create.l HWIO_BLSP1_BLSP_UART4_UART_DM_RF_14_ADDR A:0x678b3174
y.create.l HWIO_BLSP1_BLSP_UART4_UART_DM_RF_15_ADDR A:0x678b3178
y.create.l HWIO_BLSP1_BLSP_UART4_UART_DM_RF_16_ADDR A:0x678b317c
y.create.l HWIO_BLSP1_BLSP_UART4_UART_DM_UIM_CFG_ADDR A:0x678b3180
y.create.l HWIO_BLSP1_BLSP_UART4_UART_DM_UIM_CMD_ADDR A:0x678b3184
y.create.l HWIO_BLSP1_BLSP_UART4_UART_DM_UIM_IO_STATUS_ADDR A:0x678b3188
y.create.l HWIO_BLSP1_BLSP_UART4_UART_DM_UIM_IRQ_ISR_ADDR A:0x678b318c
y.create.l HWIO_BLSP1_BLSP_UART4_UART_DM_UIM_IRQ_MISR_ADDR A:0x678b3190
y.create.l HWIO_BLSP1_BLSP_UART4_UART_DM_UIM_IRQ_CLR_ADDR A:0x678b3194
y.create.l HWIO_BLSP1_BLSP_UART4_UART_DM_UIM_IRQ_IMR_ADDR A:0x678b3198
y.create.l HWIO_BLSP1_BLSP_UART4_UART_DM_UIM_IRQ_IMR_SET_ADDR A:0x678b319c
y.create.l HWIO_BLSP1_BLSP_UART4_UART_DM_UIM_IRQ_IMR_CLR_ADDR A:0x678b31a0
y.create.l HWIO_BLSP1_BLSP_UART5_UART_DM_MR1_ADDR A:0x678b4000
y.create.l HWIO_BLSP1_BLSP_UART5_UART_DM_MR2_ADDR A:0x678b4004
y.create.l HWIO_BLSP1_BLSP_UART5_UART_DM_CSR_SR_DEPRECATED_ADDR A:0x678b4008
y.create.l HWIO_BLSP1_BLSP_UART5_UART_DM_CR_MISR_DEPRECATED_ADDR A:0x678b4010
y.create.l HWIO_BLSP1_BLSP_UART5_UART_DM_IMR_ISR_DEPRECATED_ADDR A:0x678b4014
y.create.l HWIO_BLSP1_BLSP_UART5_UART_DM_IPR_ADDR A:0x678b4018
y.create.l HWIO_BLSP1_BLSP_UART5_UART_DM_TFWR_ADDR A:0x678b401c
y.create.l HWIO_BLSP1_BLSP_UART5_UART_DM_RFWR_ADDR A:0x678b4020
y.create.l HWIO_BLSP1_BLSP_UART5_UART_DM_HCR_ADDR A:0x678b4024
y.create.l HWIO_BLSP1_BLSP_UART5_UART_DM_DMRX_ADDR A:0x678b4034
y.create.l HWIO_BLSP1_BLSP_UART5_UART_DM_IRDA_RX_TOTAL_SNAP_DEPRECATED_ADDR A:0x678b4038
y.create.l HWIO_BLSP1_BLSP_UART5_UART_DM_DMEN_ADDR A:0x678b403c
y.create.l HWIO_BLSP1_BLSP_UART5_UART_DM_NO_CHARS_FOR_TX_ADDR A:0x678b4040
y.create.l HWIO_BLSP1_BLSP_UART5_UART_DM_BADR_ADDR A:0x678b4044
y.create.l HWIO_BLSP1_BLSP_UART5_UART_DM_TESTSL_ADDR A:0x678b4048
y.create.l HWIO_BLSP1_BLSP_UART5_UART_DM_TXFS_ADDR A:0x678b404c
y.create.l HWIO_BLSP1_BLSP_UART5_UART_DM_RXFS_ADDR A:0x678b4050
y.create.l HWIO_BLSP1_BLSP_UART5_UART_DM_MISR_MODE_ADDR A:0x678b4060
y.create.l HWIO_BLSP1_BLSP_UART5_UART_DM_MISR_RESET_ADDR A:0x678b4064
y.create.l HWIO_BLSP1_BLSP_UART5_UART_DM_MISR_EXPORT_ADDR A:0x678b4068
y.create.l HWIO_BLSP1_BLSP_UART5_UART_DM_MISR_VAL_ADDR A:0x678b406c
y.create.l HWIO_BLSP1_BLSP_UART5_UART_DM_TF_RF_DEPRECATED_ADDR A:0x678b4070
y.create.l HWIO_BLSP1_BLSP_UART5_UART_DM_TF_RF_2_DEPRECATED_ADDR A:0x678b4074
y.create.l HWIO_BLSP1_BLSP_UART5_UART_DM_TF_RF_3_DEPRECATED_ADDR A:0x678b4078
y.create.l HWIO_BLSP1_BLSP_UART5_UART_DM_TF_RF_4_DEPRECATED_ADDR A:0x678b407c
y.create.l HWIO_BLSP1_BLSP_UART5_UART_DM_SIM_CFG_ADDR A:0x678b4080
y.create.l HWIO_BLSP1_BLSP_UART5_UART_DM_TEST_WR_ADDR_ADDR A:0x678b4084
y.create.l HWIO_BLSP1_BLSP_UART5_UART_DM_TEST_WR_DATA_ADDR A:0x678b4088
y.create.l HWIO_BLSP1_BLSP_UART5_UART_DM_TEST_RD_ADDR_ADDR A:0x678b408c
y.create.l HWIO_BLSP1_BLSP_UART5_UART_DM_TEST_RD_DATA_ADDR A:0x678b4090
y.create.l HWIO_BLSP1_BLSP_UART5_UART_DM_CSR_ADDR A:0x678b40a0
y.create.l HWIO_BLSP1_BLSP_UART5_UART_DM_SR_ADDR A:0x678b40a4
y.create.l HWIO_BLSP1_BLSP_UART5_UART_DM_CR_ADDR A:0x678b40a8
y.create.l HWIO_BLSP1_BLSP_UART5_UART_DM_MISR_ADDR A:0x678b40ac
y.create.l HWIO_BLSP1_BLSP_UART5_UART_DM_IMR_ADDR A:0x678b40b0
y.create.l HWIO_BLSP1_BLSP_UART5_UART_DM_ISR_ADDR A:0x678b40b4
y.create.l HWIO_BLSP1_BLSP_UART5_UART_DM_IRDA_ADDR A:0x678b40b8
y.create.l HWIO_BLSP1_BLSP_UART5_UART_DM_RX_TOTAL_SNAP_ADDR A:0x678b40bc
y.create.l HWIO_BLSP1_BLSP_UART5_UART_DM_WWT_TIMEOUT_ADDR A:0x678b40c0
y.create.l HWIO_BLSP1_BLSP_UART5_UART_DM_CLK_CTRL_ADDR A:0x678b40c4
y.create.l HWIO_BLSP1_BLSP_UART5_UART_DM_BCR_ADDR A:0x678b40c8
y.create.l HWIO_BLSP1_BLSP_UART5_UART_DM_RX_TRANS_CTRL_ADDR A:0x678b40cc
y.create.l HWIO_BLSP1_BLSP_UART5_UART_DM_DMRX_DBG_ADDR A:0x678b40d0
y.create.l HWIO_BLSP1_BLSP_UART5_UART_DM_FSM_STATUS_ADDR A:0x678b40d4
y.create.l HWIO_BLSP1_BLSP_UART5_UART_DM_HW_VERSION_ADDR A:0x678b40d8
y.create.l HWIO_BLSP1_BLSP_UART5_UART_DM_GENERICS_ADDR A:0x678b40dc
y.create.l HWIO_BLSP1_BLSP_UART5_UART_DM_ISR_CLR_ADDR A:0x678b40e0
y.create.l HWIO_BLSP1_BLSP_UART5_UART_DM_TF_ADDR A:0x678b4100
y.create.l HWIO_BLSP1_BLSP_UART5_UART_DM_TF_2_ADDR A:0x678b4104
y.create.l HWIO_BLSP1_BLSP_UART5_UART_DM_TF_3_ADDR A:0x678b4108
y.create.l HWIO_BLSP1_BLSP_UART5_UART_DM_TF_4_ADDR A:0x678b410c
y.create.l HWIO_BLSP1_BLSP_UART5_UART_DM_TF_5_ADDR A:0x678b4110
y.create.l HWIO_BLSP1_BLSP_UART5_UART_DM_TF_6_ADDR A:0x678b4114
y.create.l HWIO_BLSP1_BLSP_UART5_UART_DM_TF_7_ADDR A:0x678b4118
y.create.l HWIO_BLSP1_BLSP_UART5_UART_DM_TF_8_ADDR A:0x678b411c
y.create.l HWIO_BLSP1_BLSP_UART5_UART_DM_TF_9_ADDR A:0x678b4120
y.create.l HWIO_BLSP1_BLSP_UART5_UART_DM_TF_10_ADDR A:0x678b4124
y.create.l HWIO_BLSP1_BLSP_UART5_UART_DM_TF_11_ADDR A:0x678b4128
y.create.l HWIO_BLSP1_BLSP_UART5_UART_DM_TF_12_ADDR A:0x678b412c
y.create.l HWIO_BLSP1_BLSP_UART5_UART_DM_TF_13_ADDR A:0x678b4130
y.create.l HWIO_BLSP1_BLSP_UART5_UART_DM_TF_14_ADDR A:0x678b4134
y.create.l HWIO_BLSP1_BLSP_UART5_UART_DM_TF_15_ADDR A:0x678b4138
y.create.l HWIO_BLSP1_BLSP_UART5_UART_DM_TF_16_ADDR A:0x678b413c
y.create.l HWIO_BLSP1_BLSP_UART5_UART_DM_RF_ADDR A:0x678b4140
y.create.l HWIO_BLSP1_BLSP_UART5_UART_DM_RF_2_ADDR A:0x678b4144
y.create.l HWIO_BLSP1_BLSP_UART5_UART_DM_RF_3_ADDR A:0x678b4148
y.create.l HWIO_BLSP1_BLSP_UART5_UART_DM_RF_4_ADDR A:0x678b414c
y.create.l HWIO_BLSP1_BLSP_UART5_UART_DM_RF_5_ADDR A:0x678b4150
y.create.l HWIO_BLSP1_BLSP_UART5_UART_DM_RF_6_ADDR A:0x678b4154
y.create.l HWIO_BLSP1_BLSP_UART5_UART_DM_RF_7_ADDR A:0x678b4158
y.create.l HWIO_BLSP1_BLSP_UART5_UART_DM_RF_8_ADDR A:0x678b415c
y.create.l HWIO_BLSP1_BLSP_UART5_UART_DM_RF_9_ADDR A:0x678b4160
y.create.l HWIO_BLSP1_BLSP_UART5_UART_DM_RF_10_ADDR A:0x678b4164
y.create.l HWIO_BLSP1_BLSP_UART5_UART_DM_RF_11_ADDR A:0x678b4168
y.create.l HWIO_BLSP1_BLSP_UART5_UART_DM_RF_12_ADDR A:0x678b416c
y.create.l HWIO_BLSP1_BLSP_UART5_UART_DM_RF_13_ADDR A:0x678b4170
y.create.l HWIO_BLSP1_BLSP_UART5_UART_DM_RF_14_ADDR A:0x678b4174
y.create.l HWIO_BLSP1_BLSP_UART5_UART_DM_RF_15_ADDR A:0x678b4178
y.create.l HWIO_BLSP1_BLSP_UART5_UART_DM_RF_16_ADDR A:0x678b417c
y.create.l HWIO_BLSP1_BLSP_UART5_UART_DM_UIM_CFG_ADDR A:0x678b4180
y.create.l HWIO_BLSP1_BLSP_UART5_UART_DM_UIM_CMD_ADDR A:0x678b4184
y.create.l HWIO_BLSP1_BLSP_UART5_UART_DM_UIM_IO_STATUS_ADDR A:0x678b4188
y.create.l HWIO_BLSP1_BLSP_UART5_UART_DM_UIM_IRQ_ISR_ADDR A:0x678b418c
y.create.l HWIO_BLSP1_BLSP_UART5_UART_DM_UIM_IRQ_MISR_ADDR A:0x678b4190
y.create.l HWIO_BLSP1_BLSP_UART5_UART_DM_UIM_IRQ_CLR_ADDR A:0x678b4194
y.create.l HWIO_BLSP1_BLSP_UART5_UART_DM_UIM_IRQ_IMR_ADDR A:0x678b4198
y.create.l HWIO_BLSP1_BLSP_UART5_UART_DM_UIM_IRQ_IMR_SET_ADDR A:0x678b419c
y.create.l HWIO_BLSP1_BLSP_UART5_UART_DM_UIM_IRQ_IMR_CLR_ADDR A:0x678b41a0
y.create.l HWIO_BLSP1_BLSP_QUP0_QUP_CONFIG_ADDR A:0x678b5000
y.create.l HWIO_BLSP1_BLSP_QUP0_QUP_STATE_ADDR A:0x678b5004
y.create.l HWIO_BLSP1_BLSP_QUP0_QUP_IO_MODES_ADDR A:0x678b5008
y.create.l HWIO_BLSP1_BLSP_QUP0_QUP_SW_RESET_ADDR A:0x678b500c
y.create.l HWIO_BLSP1_BLSP_QUP0_QUP_TRANSFER_CANCEL_ADDR A:0x678b5014
y.create.l HWIO_BLSP1_BLSP_QUP0_QUP_OPERATIONAL_ADDR A:0x678b5018
y.create.l HWIO_BLSP1_BLSP_QUP0_QUP_ERROR_FLAGS_ADDR A:0x678b501c
y.create.l HWIO_BLSP1_BLSP_QUP0_QUP_ERROR_FLAGS_EN_ADDR A:0x678b5020
y.create.l HWIO_BLSP1_BLSP_QUP0_QUP_TEST_CTRL_ADDR A:0x678b5024
y.create.l HWIO_BLSP1_BLSP_QUP0_QUP_OPERATIONAL_MASK_ADDR A:0x678b5028
y.create.l HWIO_BLSP1_BLSP_QUP0_QUP_HW_VERSION_ADDR A:0x678b5030
y.create.l HWIO_BLSP1_BLSP_QUP0_QUP_MX_OUTPUT_COUNT_ADDR A:0x678b5100
y.create.l HWIO_BLSP1_BLSP_QUP0_QUP_MX_OUTPUT_CNT_CURRENT_ADDR A:0x678b5104
y.create.l HWIO_BLSP1_BLSP_QUP0_QUP_OUTPUT_DEBUG_ADDR A:0x678b5108
y.create.l HWIO_BLSP1_BLSP_QUP0_QUP_OUTPUT_FIFO_WORD_CNT_ADDR A:0x678b510c
y.create.l HWIO_BLSP1_BLSP_QUP0_QUP_OUTPUT_FIFO0_ADDR A:0x678b5110
y.create.l HWIO_BLSP1_BLSP_QUP0_QUP_OUTPUT_FIFO1_ADDR A:0x678b5114
y.create.l HWIO_BLSP1_BLSP_QUP0_QUP_OUTPUT_FIFO2_ADDR A:0x678b5118
y.create.l HWIO_BLSP1_BLSP_QUP0_QUP_OUTPUT_FIFO3_ADDR A:0x678b511c
y.create.l HWIO_BLSP1_BLSP_QUP0_QUP_OUTPUT_FIFO4_ADDR A:0x678b5120
y.create.l HWIO_BLSP1_BLSP_QUP0_QUP_OUTPUT_FIFO5_ADDR A:0x678b5124
y.create.l HWIO_BLSP1_BLSP_QUP0_QUP_OUTPUT_FIFO6_ADDR A:0x678b5128
y.create.l HWIO_BLSP1_BLSP_QUP0_QUP_OUTPUT_FIFO7_ADDR A:0x678b512c
y.create.l HWIO_BLSP1_BLSP_QUP0_QUP_OUTPUT_FIFO8_ADDR A:0x678b5130
y.create.l HWIO_BLSP1_BLSP_QUP0_QUP_OUTPUT_FIFO9_ADDR A:0x678b5134
y.create.l HWIO_BLSP1_BLSP_QUP0_QUP_MX_WRITE_COUNT_ADDR A:0x678b5150
y.create.l HWIO_BLSP1_BLSP_QUP0_QUP_MX_WRITE_CNT_CURRENT_ADDR A:0x678b5154
y.create.l HWIO_BLSP1_BLSP_QUP0_QUP_MX_INPUT_COUNT_ADDR A:0x678b5200
y.create.l HWIO_BLSP1_BLSP_QUP0_QUP_MX_INPUT_CNT_CURRENT_ADDR A:0x678b5204
y.create.l HWIO_BLSP1_BLSP_QUP0_QUP_MX_READ_COUNT_ADDR A:0x678b5208
y.create.l HWIO_BLSP1_BLSP_QUP0_QUP_MX_READ_CNT_CURRENT_ADDR A:0x678b520c
y.create.l HWIO_BLSP1_BLSP_QUP0_QUP_INPUT_DEBUG_ADDR A:0x678b5210
y.create.l HWIO_BLSP1_BLSP_QUP0_QUP_INPUT_FIFO_WORD_CNT_ADDR A:0x678b5214
y.create.l HWIO_BLSP1_BLSP_QUP0_QUP_INPUT_FIFO0_ADDR A:0x678b5218
y.create.l HWIO_BLSP1_BLSP_QUP0_QUP_INPUT_FIFO1_ADDR A:0x678b521c
y.create.l HWIO_BLSP1_BLSP_QUP0_QUP_INPUT_FIFO2_ADDR A:0x678b5220
y.create.l HWIO_BLSP1_BLSP_QUP0_QUP_INPUT_FIFO3_ADDR A:0x678b5224
y.create.l HWIO_BLSP1_BLSP_QUP0_QUP_INPUT_FIFO4_ADDR A:0x678b5228
y.create.l HWIO_BLSP1_BLSP_QUP0_QUP_INPUT_FIFO5_ADDR A:0x678b522c
y.create.l HWIO_BLSP1_BLSP_QUP0_QUP_INPUT_FIFO6_ADDR A:0x678b5230
y.create.l HWIO_BLSP1_BLSP_QUP0_QUP_INPUT_FIFO7_ADDR A:0x678b5234
y.create.l HWIO_BLSP1_BLSP_QUP0_QUP_INPUT_FIFO8_ADDR A:0x678b5238
y.create.l HWIO_BLSP1_BLSP_QUP0_QUP_INPUT_FIFO9_ADDR A:0x678b523c
y.create.l HWIO_BLSP1_BLSP_QUP0_SPI_CONFIG_ADDR A:0x678b5300
y.create.l HWIO_BLSP1_BLSP_QUP0_SPI_IO_CONTROL_ADDR A:0x678b5304
y.create.l HWIO_BLSP1_BLSP_QUP0_SPI_ERROR_FLAGS_ADDR A:0x678b5308
y.create.l HWIO_BLSP1_BLSP_QUP0_SPI_ERROR_FLAGS_EN_ADDR A:0x678b530c
y.create.l HWIO_BLSP1_BLSP_QUP0_SPI_DEASSERT_WAIT_ADDR A:0x678b5310
y.create.l HWIO_BLSP1_BLSP_QUP0_SPI_MASTER_LOCAL_ID_ADDR A:0x678b5314
y.create.l HWIO_BLSP1_BLSP_QUP0_SPI_MASTER_COMMAND_ADDR A:0x678b5318
y.create.l HWIO_BLSP1_BLSP_QUP0_SPI_MASTER_STATUS_ADDR A:0x678b531c
y.create.l HWIO_BLSP1_BLSP_QUP0_SPI_CHAR_CFG_ADDR A:0x678b5320
y.create.l HWIO_BLSP1_BLSP_QUP0_SPI_CHAR_DATA_SPI_CS_ADDR A:0x678b5324
y.create.l HWIO_BLSP1_BLSP_QUP0_SPI_CHAR_DATA_SPI_MOSI_ADDR A:0x678b5328
y.create.l HWIO_BLSP1_BLSP_QUP0_SPI_CHAR_DATA_SPI_MISO_ADDR A:0x678b532c
y.create.l HWIO_BLSP1_BLSP_QUP0_SPI_SLAVE_IRQ_STATUS_ADDR A:0x678b5330
y.create.l HWIO_BLSP1_BLSP_QUP0_SPI_SLAVE_IRQ_EN_ADDR A:0x678b5334
y.create.l HWIO_BLSP1_BLSP_QUP0_SPI_SLAVE_CFG_ADDR A:0x678b5338
y.create.l HWIO_BLSP1_BLSP_QUP0_SPI_SLAVE_DEBUG_ADDR A:0x678b533c
y.create.l HWIO_BLSP1_BLSP_QUP0_I2C_MASTER_CLK_CTL_ADDR A:0x678b5400
y.create.l HWIO_BLSP1_BLSP_QUP0_I2C_MASTER_STATUS_ADDR A:0x678b5404
y.create.l HWIO_BLSP1_BLSP_QUP0_I2C_MASTER_CONFIG_ADDR A:0x678b5408
y.create.l HWIO_BLSP1_BLSP_QUP0_I2C_MASTER_BUS_CLEAR_ADDR A:0x678b540c
y.create.l HWIO_BLSP1_BLSP_QUP0_I2C_MASTER_LOCAL_ID_ADDR A:0x678b5410
y.create.l HWIO_BLSP1_BLSP_QUP0_I2C_MASTER_COMMAND_ADDR A:0x678b5414
y.create.l HWIO_BLSP1_BLSP_QUP1_QUP_CONFIG_ADDR A:0x678b6000
y.create.l HWIO_BLSP1_BLSP_QUP1_QUP_STATE_ADDR A:0x678b6004
y.create.l HWIO_BLSP1_BLSP_QUP1_QUP_IO_MODES_ADDR A:0x678b6008
y.create.l HWIO_BLSP1_BLSP_QUP1_QUP_SW_RESET_ADDR A:0x678b600c
y.create.l HWIO_BLSP1_BLSP_QUP1_QUP_TRANSFER_CANCEL_ADDR A:0x678b6014
y.create.l HWIO_BLSP1_BLSP_QUP1_QUP_OPERATIONAL_ADDR A:0x678b6018
y.create.l HWIO_BLSP1_BLSP_QUP1_QUP_ERROR_FLAGS_ADDR A:0x678b601c
y.create.l HWIO_BLSP1_BLSP_QUP1_QUP_ERROR_FLAGS_EN_ADDR A:0x678b6020
y.create.l HWIO_BLSP1_BLSP_QUP1_QUP_TEST_CTRL_ADDR A:0x678b6024
y.create.l HWIO_BLSP1_BLSP_QUP1_QUP_OPERATIONAL_MASK_ADDR A:0x678b6028
y.create.l HWIO_BLSP1_BLSP_QUP1_QUP_HW_VERSION_ADDR A:0x678b6030
y.create.l HWIO_BLSP1_BLSP_QUP1_QUP_MX_OUTPUT_COUNT_ADDR A:0x678b6100
y.create.l HWIO_BLSP1_BLSP_QUP1_QUP_MX_OUTPUT_CNT_CURRENT_ADDR A:0x678b6104
y.create.l HWIO_BLSP1_BLSP_QUP1_QUP_OUTPUT_DEBUG_ADDR A:0x678b6108
y.create.l HWIO_BLSP1_BLSP_QUP1_QUP_OUTPUT_FIFO_WORD_CNT_ADDR A:0x678b610c
y.create.l HWIO_BLSP1_BLSP_QUP1_QUP_OUTPUT_FIFO0_ADDR A:0x678b6110
y.create.l HWIO_BLSP1_BLSP_QUP1_QUP_OUTPUT_FIFO1_ADDR A:0x678b6114
y.create.l HWIO_BLSP1_BLSP_QUP1_QUP_OUTPUT_FIFO2_ADDR A:0x678b6118
y.create.l HWIO_BLSP1_BLSP_QUP1_QUP_OUTPUT_FIFO3_ADDR A:0x678b611c
y.create.l HWIO_BLSP1_BLSP_QUP1_QUP_OUTPUT_FIFO4_ADDR A:0x678b6120
y.create.l HWIO_BLSP1_BLSP_QUP1_QUP_OUTPUT_FIFO5_ADDR A:0x678b6124
y.create.l HWIO_BLSP1_BLSP_QUP1_QUP_OUTPUT_FIFO6_ADDR A:0x678b6128
y.create.l HWIO_BLSP1_BLSP_QUP1_QUP_OUTPUT_FIFO7_ADDR A:0x678b612c
y.create.l HWIO_BLSP1_BLSP_QUP1_QUP_OUTPUT_FIFO8_ADDR A:0x678b6130
y.create.l HWIO_BLSP1_BLSP_QUP1_QUP_OUTPUT_FIFO9_ADDR A:0x678b6134
y.create.l HWIO_BLSP1_BLSP_QUP1_QUP_MX_WRITE_COUNT_ADDR A:0x678b6150
y.create.l HWIO_BLSP1_BLSP_QUP1_QUP_MX_WRITE_CNT_CURRENT_ADDR A:0x678b6154
y.create.l HWIO_BLSP1_BLSP_QUP1_QUP_MX_INPUT_COUNT_ADDR A:0x678b6200
y.create.l HWIO_BLSP1_BLSP_QUP1_QUP_MX_INPUT_CNT_CURRENT_ADDR A:0x678b6204
y.create.l HWIO_BLSP1_BLSP_QUP1_QUP_MX_READ_COUNT_ADDR A:0x678b6208
y.create.l HWIO_BLSP1_BLSP_QUP1_QUP_MX_READ_CNT_CURRENT_ADDR A:0x678b620c
y.create.l HWIO_BLSP1_BLSP_QUP1_QUP_INPUT_DEBUG_ADDR A:0x678b6210
y.create.l HWIO_BLSP1_BLSP_QUP1_QUP_INPUT_FIFO_WORD_CNT_ADDR A:0x678b6214
y.create.l HWIO_BLSP1_BLSP_QUP1_QUP_INPUT_FIFO0_ADDR A:0x678b6218
y.create.l HWIO_BLSP1_BLSP_QUP1_QUP_INPUT_FIFO1_ADDR A:0x678b621c
y.create.l HWIO_BLSP1_BLSP_QUP1_QUP_INPUT_FIFO2_ADDR A:0x678b6220
y.create.l HWIO_BLSP1_BLSP_QUP1_QUP_INPUT_FIFO3_ADDR A:0x678b6224
y.create.l HWIO_BLSP1_BLSP_QUP1_QUP_INPUT_FIFO4_ADDR A:0x678b6228
y.create.l HWIO_BLSP1_BLSP_QUP1_QUP_INPUT_FIFO5_ADDR A:0x678b622c
y.create.l HWIO_BLSP1_BLSP_QUP1_QUP_INPUT_FIFO6_ADDR A:0x678b6230
y.create.l HWIO_BLSP1_BLSP_QUP1_QUP_INPUT_FIFO7_ADDR A:0x678b6234
y.create.l HWIO_BLSP1_BLSP_QUP1_QUP_INPUT_FIFO8_ADDR A:0x678b6238
y.create.l HWIO_BLSP1_BLSP_QUP1_QUP_INPUT_FIFO9_ADDR A:0x678b623c
y.create.l HWIO_BLSP1_BLSP_QUP1_SPI_CONFIG_ADDR A:0x678b6300
y.create.l HWIO_BLSP1_BLSP_QUP1_SPI_IO_CONTROL_ADDR A:0x678b6304
y.create.l HWIO_BLSP1_BLSP_QUP1_SPI_ERROR_FLAGS_ADDR A:0x678b6308
y.create.l HWIO_BLSP1_BLSP_QUP1_SPI_ERROR_FLAGS_EN_ADDR A:0x678b630c
y.create.l HWIO_BLSP1_BLSP_QUP1_SPI_DEASSERT_WAIT_ADDR A:0x678b6310
y.create.l HWIO_BLSP1_BLSP_QUP1_SPI_MASTER_LOCAL_ID_ADDR A:0x678b6314
y.create.l HWIO_BLSP1_BLSP_QUP1_SPI_MASTER_COMMAND_ADDR A:0x678b6318
y.create.l HWIO_BLSP1_BLSP_QUP1_SPI_MASTER_STATUS_ADDR A:0x678b631c
y.create.l HWIO_BLSP1_BLSP_QUP1_SPI_CHAR_CFG_ADDR A:0x678b6320
y.create.l HWIO_BLSP1_BLSP_QUP1_SPI_CHAR_DATA_SPI_CS_ADDR A:0x678b6324
y.create.l HWIO_BLSP1_BLSP_QUP1_SPI_CHAR_DATA_SPI_MOSI_ADDR A:0x678b6328
y.create.l HWIO_BLSP1_BLSP_QUP1_SPI_CHAR_DATA_SPI_MISO_ADDR A:0x678b632c
y.create.l HWIO_BLSP1_BLSP_QUP1_SPI_SLAVE_IRQ_STATUS_ADDR A:0x678b6330
y.create.l HWIO_BLSP1_BLSP_QUP1_SPI_SLAVE_IRQ_EN_ADDR A:0x678b6334
y.create.l HWIO_BLSP1_BLSP_QUP1_SPI_SLAVE_CFG_ADDR A:0x678b6338
y.create.l HWIO_BLSP1_BLSP_QUP1_SPI_SLAVE_DEBUG_ADDR A:0x678b633c
y.create.l HWIO_BLSP1_BLSP_QUP1_I2C_MASTER_CLK_CTL_ADDR A:0x678b6400
y.create.l HWIO_BLSP1_BLSP_QUP1_I2C_MASTER_STATUS_ADDR A:0x678b6404
y.create.l HWIO_BLSP1_BLSP_QUP1_I2C_MASTER_CONFIG_ADDR A:0x678b6408
y.create.l HWIO_BLSP1_BLSP_QUP1_I2C_MASTER_BUS_CLEAR_ADDR A:0x678b640c
y.create.l HWIO_BLSP1_BLSP_QUP1_I2C_MASTER_LOCAL_ID_ADDR A:0x678b6410
y.create.l HWIO_BLSP1_BLSP_QUP1_I2C_MASTER_COMMAND_ADDR A:0x678b6414
y.create.l HWIO_BLSP1_BLSP_QUP2_QUP_CONFIG_ADDR A:0x678b7000
y.create.l HWIO_BLSP1_BLSP_QUP2_QUP_STATE_ADDR A:0x678b7004
y.create.l HWIO_BLSP1_BLSP_QUP2_QUP_IO_MODES_ADDR A:0x678b7008
y.create.l HWIO_BLSP1_BLSP_QUP2_QUP_SW_RESET_ADDR A:0x678b700c
y.create.l HWIO_BLSP1_BLSP_QUP2_QUP_TRANSFER_CANCEL_ADDR A:0x678b7014
y.create.l HWIO_BLSP1_BLSP_QUP2_QUP_OPERATIONAL_ADDR A:0x678b7018
y.create.l HWIO_BLSP1_BLSP_QUP2_QUP_ERROR_FLAGS_ADDR A:0x678b701c
y.create.l HWIO_BLSP1_BLSP_QUP2_QUP_ERROR_FLAGS_EN_ADDR A:0x678b7020
y.create.l HWIO_BLSP1_BLSP_QUP2_QUP_TEST_CTRL_ADDR A:0x678b7024
y.create.l HWIO_BLSP1_BLSP_QUP2_QUP_OPERATIONAL_MASK_ADDR A:0x678b7028
y.create.l HWIO_BLSP1_BLSP_QUP2_QUP_HW_VERSION_ADDR A:0x678b7030
y.create.l HWIO_BLSP1_BLSP_QUP2_QUP_MX_OUTPUT_COUNT_ADDR A:0x678b7100
y.create.l HWIO_BLSP1_BLSP_QUP2_QUP_MX_OUTPUT_CNT_CURRENT_ADDR A:0x678b7104
y.create.l HWIO_BLSP1_BLSP_QUP2_QUP_OUTPUT_DEBUG_ADDR A:0x678b7108
y.create.l HWIO_BLSP1_BLSP_QUP2_QUP_OUTPUT_FIFO_WORD_CNT_ADDR A:0x678b710c
y.create.l HWIO_BLSP1_BLSP_QUP2_QUP_OUTPUT_FIFO0_ADDR A:0x678b7110
y.create.l HWIO_BLSP1_BLSP_QUP2_QUP_OUTPUT_FIFO1_ADDR A:0x678b7114
y.create.l HWIO_BLSP1_BLSP_QUP2_QUP_OUTPUT_FIFO2_ADDR A:0x678b7118
y.create.l HWIO_BLSP1_BLSP_QUP2_QUP_OUTPUT_FIFO3_ADDR A:0x678b711c
y.create.l HWIO_BLSP1_BLSP_QUP2_QUP_OUTPUT_FIFO4_ADDR A:0x678b7120
y.create.l HWIO_BLSP1_BLSP_QUP2_QUP_OUTPUT_FIFO5_ADDR A:0x678b7124
y.create.l HWIO_BLSP1_BLSP_QUP2_QUP_OUTPUT_FIFO6_ADDR A:0x678b7128
y.create.l HWIO_BLSP1_BLSP_QUP2_QUP_OUTPUT_FIFO7_ADDR A:0x678b712c
y.create.l HWIO_BLSP1_BLSP_QUP2_QUP_OUTPUT_FIFO8_ADDR A:0x678b7130
y.create.l HWIO_BLSP1_BLSP_QUP2_QUP_OUTPUT_FIFO9_ADDR A:0x678b7134
y.create.l HWIO_BLSP1_BLSP_QUP2_QUP_MX_WRITE_COUNT_ADDR A:0x678b7150
y.create.l HWIO_BLSP1_BLSP_QUP2_QUP_MX_WRITE_CNT_CURRENT_ADDR A:0x678b7154
y.create.l HWIO_BLSP1_BLSP_QUP2_QUP_MX_INPUT_COUNT_ADDR A:0x678b7200
y.create.l HWIO_BLSP1_BLSP_QUP2_QUP_MX_INPUT_CNT_CURRENT_ADDR A:0x678b7204
y.create.l HWIO_BLSP1_BLSP_QUP2_QUP_MX_READ_COUNT_ADDR A:0x678b7208
y.create.l HWIO_BLSP1_BLSP_QUP2_QUP_MX_READ_CNT_CURRENT_ADDR A:0x678b720c
y.create.l HWIO_BLSP1_BLSP_QUP2_QUP_INPUT_DEBUG_ADDR A:0x678b7210
y.create.l HWIO_BLSP1_BLSP_QUP2_QUP_INPUT_FIFO_WORD_CNT_ADDR A:0x678b7214
y.create.l HWIO_BLSP1_BLSP_QUP2_QUP_INPUT_FIFO0_ADDR A:0x678b7218
y.create.l HWIO_BLSP1_BLSP_QUP2_QUP_INPUT_FIFO1_ADDR A:0x678b721c
y.create.l HWIO_BLSP1_BLSP_QUP2_QUP_INPUT_FIFO2_ADDR A:0x678b7220
y.create.l HWIO_BLSP1_BLSP_QUP2_QUP_INPUT_FIFO3_ADDR A:0x678b7224
y.create.l HWIO_BLSP1_BLSP_QUP2_QUP_INPUT_FIFO4_ADDR A:0x678b7228
y.create.l HWIO_BLSP1_BLSP_QUP2_QUP_INPUT_FIFO5_ADDR A:0x678b722c
y.create.l HWIO_BLSP1_BLSP_QUP2_QUP_INPUT_FIFO6_ADDR A:0x678b7230
y.create.l HWIO_BLSP1_BLSP_QUP2_QUP_INPUT_FIFO7_ADDR A:0x678b7234
y.create.l HWIO_BLSP1_BLSP_QUP2_QUP_INPUT_FIFO8_ADDR A:0x678b7238
y.create.l HWIO_BLSP1_BLSP_QUP2_QUP_INPUT_FIFO9_ADDR A:0x678b723c
y.create.l HWIO_BLSP1_BLSP_QUP2_SPI_CONFIG_ADDR A:0x678b7300
y.create.l HWIO_BLSP1_BLSP_QUP2_SPI_IO_CONTROL_ADDR A:0x678b7304
y.create.l HWIO_BLSP1_BLSP_QUP2_SPI_ERROR_FLAGS_ADDR A:0x678b7308
y.create.l HWIO_BLSP1_BLSP_QUP2_SPI_ERROR_FLAGS_EN_ADDR A:0x678b730c
y.create.l HWIO_BLSP1_BLSP_QUP2_SPI_DEASSERT_WAIT_ADDR A:0x678b7310
y.create.l HWIO_BLSP1_BLSP_QUP2_SPI_MASTER_LOCAL_ID_ADDR A:0x678b7314
y.create.l HWIO_BLSP1_BLSP_QUP2_SPI_MASTER_COMMAND_ADDR A:0x678b7318
y.create.l HWIO_BLSP1_BLSP_QUP2_SPI_MASTER_STATUS_ADDR A:0x678b731c
y.create.l HWIO_BLSP1_BLSP_QUP2_SPI_CHAR_CFG_ADDR A:0x678b7320
y.create.l HWIO_BLSP1_BLSP_QUP2_SPI_CHAR_DATA_SPI_CS_ADDR A:0x678b7324
y.create.l HWIO_BLSP1_BLSP_QUP2_SPI_CHAR_DATA_SPI_MOSI_ADDR A:0x678b7328
y.create.l HWIO_BLSP1_BLSP_QUP2_SPI_CHAR_DATA_SPI_MISO_ADDR A:0x678b732c
y.create.l HWIO_BLSP1_BLSP_QUP2_SPI_SLAVE_IRQ_STATUS_ADDR A:0x678b7330
y.create.l HWIO_BLSP1_BLSP_QUP2_SPI_SLAVE_IRQ_EN_ADDR A:0x678b7334
y.create.l HWIO_BLSP1_BLSP_QUP2_SPI_SLAVE_CFG_ADDR A:0x678b7338
y.create.l HWIO_BLSP1_BLSP_QUP2_SPI_SLAVE_DEBUG_ADDR A:0x678b733c
y.create.l HWIO_BLSP1_BLSP_QUP2_I2C_MASTER_CLK_CTL_ADDR A:0x678b7400
y.create.l HWIO_BLSP1_BLSP_QUP2_I2C_MASTER_STATUS_ADDR A:0x678b7404
y.create.l HWIO_BLSP1_BLSP_QUP2_I2C_MASTER_CONFIG_ADDR A:0x678b7408
y.create.l HWIO_BLSP1_BLSP_QUP2_I2C_MASTER_BUS_CLEAR_ADDR A:0x678b740c
y.create.l HWIO_BLSP1_BLSP_QUP2_I2C_MASTER_LOCAL_ID_ADDR A:0x678b7410
y.create.l HWIO_BLSP1_BLSP_QUP2_I2C_MASTER_COMMAND_ADDR A:0x678b7414
y.create.l HWIO_BLSP1_BLSP_QUP3_QUP_CONFIG_ADDR A:0x678b8000
y.create.l HWIO_BLSP1_BLSP_QUP3_QUP_STATE_ADDR A:0x678b8004
y.create.l HWIO_BLSP1_BLSP_QUP3_QUP_IO_MODES_ADDR A:0x678b8008
y.create.l HWIO_BLSP1_BLSP_QUP3_QUP_SW_RESET_ADDR A:0x678b800c
y.create.l HWIO_BLSP1_BLSP_QUP3_QUP_TRANSFER_CANCEL_ADDR A:0x678b8014
y.create.l HWIO_BLSP1_BLSP_QUP3_QUP_OPERATIONAL_ADDR A:0x678b8018
y.create.l HWIO_BLSP1_BLSP_QUP3_QUP_ERROR_FLAGS_ADDR A:0x678b801c
y.create.l HWIO_BLSP1_BLSP_QUP3_QUP_ERROR_FLAGS_EN_ADDR A:0x678b8020
y.create.l HWIO_BLSP1_BLSP_QUP3_QUP_TEST_CTRL_ADDR A:0x678b8024
y.create.l HWIO_BLSP1_BLSP_QUP3_QUP_OPERATIONAL_MASK_ADDR A:0x678b8028
y.create.l HWIO_BLSP1_BLSP_QUP3_QUP_HW_VERSION_ADDR A:0x678b8030
y.create.l HWIO_BLSP1_BLSP_QUP3_QUP_MX_OUTPUT_COUNT_ADDR A:0x678b8100
y.create.l HWIO_BLSP1_BLSP_QUP3_QUP_MX_OUTPUT_CNT_CURRENT_ADDR A:0x678b8104
y.create.l HWIO_BLSP1_BLSP_QUP3_QUP_OUTPUT_DEBUG_ADDR A:0x678b8108
y.create.l HWIO_BLSP1_BLSP_QUP3_QUP_OUTPUT_FIFO_WORD_CNT_ADDR A:0x678b810c
y.create.l HWIO_BLSP1_BLSP_QUP3_QUP_OUTPUT_FIFO0_ADDR A:0x678b8110
y.create.l HWIO_BLSP1_BLSP_QUP3_QUP_OUTPUT_FIFO1_ADDR A:0x678b8114
y.create.l HWIO_BLSP1_BLSP_QUP3_QUP_OUTPUT_FIFO2_ADDR A:0x678b8118
y.create.l HWIO_BLSP1_BLSP_QUP3_QUP_OUTPUT_FIFO3_ADDR A:0x678b811c
y.create.l HWIO_BLSP1_BLSP_QUP3_QUP_OUTPUT_FIFO4_ADDR A:0x678b8120
y.create.l HWIO_BLSP1_BLSP_QUP3_QUP_OUTPUT_FIFO5_ADDR A:0x678b8124
y.create.l HWIO_BLSP1_BLSP_QUP3_QUP_OUTPUT_FIFO6_ADDR A:0x678b8128
y.create.l HWIO_BLSP1_BLSP_QUP3_QUP_OUTPUT_FIFO7_ADDR A:0x678b812c
y.create.l HWIO_BLSP1_BLSP_QUP3_QUP_OUTPUT_FIFO8_ADDR A:0x678b8130
y.create.l HWIO_BLSP1_BLSP_QUP3_QUP_OUTPUT_FIFO9_ADDR A:0x678b8134
y.create.l HWIO_BLSP1_BLSP_QUP3_QUP_MX_WRITE_COUNT_ADDR A:0x678b8150
y.create.l HWIO_BLSP1_BLSP_QUP3_QUP_MX_WRITE_CNT_CURRENT_ADDR A:0x678b8154
y.create.l HWIO_BLSP1_BLSP_QUP3_QUP_MX_INPUT_COUNT_ADDR A:0x678b8200
y.create.l HWIO_BLSP1_BLSP_QUP3_QUP_MX_INPUT_CNT_CURRENT_ADDR A:0x678b8204
y.create.l HWIO_BLSP1_BLSP_QUP3_QUP_MX_READ_COUNT_ADDR A:0x678b8208
y.create.l HWIO_BLSP1_BLSP_QUP3_QUP_MX_READ_CNT_CURRENT_ADDR A:0x678b820c
y.create.l HWIO_BLSP1_BLSP_QUP3_QUP_INPUT_DEBUG_ADDR A:0x678b8210
y.create.l HWIO_BLSP1_BLSP_QUP3_QUP_INPUT_FIFO_WORD_CNT_ADDR A:0x678b8214
y.create.l HWIO_BLSP1_BLSP_QUP3_QUP_INPUT_FIFO0_ADDR A:0x678b8218
y.create.l HWIO_BLSP1_BLSP_QUP3_QUP_INPUT_FIFO1_ADDR A:0x678b821c
y.create.l HWIO_BLSP1_BLSP_QUP3_QUP_INPUT_FIFO2_ADDR A:0x678b8220
y.create.l HWIO_BLSP1_BLSP_QUP3_QUP_INPUT_FIFO3_ADDR A:0x678b8224
y.create.l HWIO_BLSP1_BLSP_QUP3_QUP_INPUT_FIFO4_ADDR A:0x678b8228
y.create.l HWIO_BLSP1_BLSP_QUP3_QUP_INPUT_FIFO5_ADDR A:0x678b822c
y.create.l HWIO_BLSP1_BLSP_QUP3_QUP_INPUT_FIFO6_ADDR A:0x678b8230
y.create.l HWIO_BLSP1_BLSP_QUP3_QUP_INPUT_FIFO7_ADDR A:0x678b8234
y.create.l HWIO_BLSP1_BLSP_QUP3_QUP_INPUT_FIFO8_ADDR A:0x678b8238
y.create.l HWIO_BLSP1_BLSP_QUP3_QUP_INPUT_FIFO9_ADDR A:0x678b823c
y.create.l HWIO_BLSP1_BLSP_QUP3_SPI_CONFIG_ADDR A:0x678b8300
y.create.l HWIO_BLSP1_BLSP_QUP3_SPI_IO_CONTROL_ADDR A:0x678b8304
y.create.l HWIO_BLSP1_BLSP_QUP3_SPI_ERROR_FLAGS_ADDR A:0x678b8308
y.create.l HWIO_BLSP1_BLSP_QUP3_SPI_ERROR_FLAGS_EN_ADDR A:0x678b830c
y.create.l HWIO_BLSP1_BLSP_QUP3_SPI_DEASSERT_WAIT_ADDR A:0x678b8310
y.create.l HWIO_BLSP1_BLSP_QUP3_SPI_MASTER_LOCAL_ID_ADDR A:0x678b8314
y.create.l HWIO_BLSP1_BLSP_QUP3_SPI_MASTER_COMMAND_ADDR A:0x678b8318
y.create.l HWIO_BLSP1_BLSP_QUP3_SPI_MASTER_STATUS_ADDR A:0x678b831c
y.create.l HWIO_BLSP1_BLSP_QUP3_SPI_CHAR_CFG_ADDR A:0x678b8320
y.create.l HWIO_BLSP1_BLSP_QUP3_SPI_CHAR_DATA_SPI_CS_ADDR A:0x678b8324
y.create.l HWIO_BLSP1_BLSP_QUP3_SPI_CHAR_DATA_SPI_MOSI_ADDR A:0x678b8328
y.create.l HWIO_BLSP1_BLSP_QUP3_SPI_CHAR_DATA_SPI_MISO_ADDR A:0x678b832c
y.create.l HWIO_BLSP1_BLSP_QUP3_SPI_SLAVE_IRQ_STATUS_ADDR A:0x678b8330
y.create.l HWIO_BLSP1_BLSP_QUP3_SPI_SLAVE_IRQ_EN_ADDR A:0x678b8334
y.create.l HWIO_BLSP1_BLSP_QUP3_SPI_SLAVE_CFG_ADDR A:0x678b8338
y.create.l HWIO_BLSP1_BLSP_QUP3_SPI_SLAVE_DEBUG_ADDR A:0x678b833c
y.create.l HWIO_BLSP1_BLSP_QUP3_I2C_MASTER_CLK_CTL_ADDR A:0x678b8400
y.create.l HWIO_BLSP1_BLSP_QUP3_I2C_MASTER_STATUS_ADDR A:0x678b8404
y.create.l HWIO_BLSP1_BLSP_QUP3_I2C_MASTER_CONFIG_ADDR A:0x678b8408
y.create.l HWIO_BLSP1_BLSP_QUP3_I2C_MASTER_BUS_CLEAR_ADDR A:0x678b840c
y.create.l HWIO_BLSP1_BLSP_QUP3_I2C_MASTER_LOCAL_ID_ADDR A:0x678b8410
y.create.l HWIO_BLSP1_BLSP_QUP3_I2C_MASTER_COMMAND_ADDR A:0x678b8414
y.create.l HWIO_BLSP1_BLSP_QUP4_QUP_CONFIG_ADDR A:0x678b9000
y.create.l HWIO_BLSP1_BLSP_QUP4_QUP_STATE_ADDR A:0x678b9004
y.create.l HWIO_BLSP1_BLSP_QUP4_QUP_IO_MODES_ADDR A:0x678b9008
y.create.l HWIO_BLSP1_BLSP_QUP4_QUP_SW_RESET_ADDR A:0x678b900c
y.create.l HWIO_BLSP1_BLSP_QUP4_QUP_TRANSFER_CANCEL_ADDR A:0x678b9014
y.create.l HWIO_BLSP1_BLSP_QUP4_QUP_OPERATIONAL_ADDR A:0x678b9018
y.create.l HWIO_BLSP1_BLSP_QUP4_QUP_ERROR_FLAGS_ADDR A:0x678b901c
y.create.l HWIO_BLSP1_BLSP_QUP4_QUP_ERROR_FLAGS_EN_ADDR A:0x678b9020
y.create.l HWIO_BLSP1_BLSP_QUP4_QUP_TEST_CTRL_ADDR A:0x678b9024
y.create.l HWIO_BLSP1_BLSP_QUP4_QUP_OPERATIONAL_MASK_ADDR A:0x678b9028
y.create.l HWIO_BLSP1_BLSP_QUP4_QUP_HW_VERSION_ADDR A:0x678b9030
y.create.l HWIO_BLSP1_BLSP_QUP4_QUP_MX_OUTPUT_COUNT_ADDR A:0x678b9100
y.create.l HWIO_BLSP1_BLSP_QUP4_QUP_MX_OUTPUT_CNT_CURRENT_ADDR A:0x678b9104
y.create.l HWIO_BLSP1_BLSP_QUP4_QUP_OUTPUT_DEBUG_ADDR A:0x678b9108
y.create.l HWIO_BLSP1_BLSP_QUP4_QUP_OUTPUT_FIFO_WORD_CNT_ADDR A:0x678b910c
y.create.l HWIO_BLSP1_BLSP_QUP4_QUP_OUTPUT_FIFO0_ADDR A:0x678b9110
y.create.l HWIO_BLSP1_BLSP_QUP4_QUP_OUTPUT_FIFO1_ADDR A:0x678b9114
y.create.l HWIO_BLSP1_BLSP_QUP4_QUP_OUTPUT_FIFO2_ADDR A:0x678b9118
y.create.l HWIO_BLSP1_BLSP_QUP4_QUP_OUTPUT_FIFO3_ADDR A:0x678b911c
y.create.l HWIO_BLSP1_BLSP_QUP4_QUP_OUTPUT_FIFO4_ADDR A:0x678b9120
y.create.l HWIO_BLSP1_BLSP_QUP4_QUP_OUTPUT_FIFO5_ADDR A:0x678b9124
y.create.l HWIO_BLSP1_BLSP_QUP4_QUP_OUTPUT_FIFO6_ADDR A:0x678b9128
y.create.l HWIO_BLSP1_BLSP_QUP4_QUP_OUTPUT_FIFO7_ADDR A:0x678b912c
y.create.l HWIO_BLSP1_BLSP_QUP4_QUP_OUTPUT_FIFO8_ADDR A:0x678b9130
y.create.l HWIO_BLSP1_BLSP_QUP4_QUP_OUTPUT_FIFO9_ADDR A:0x678b9134
y.create.l HWIO_BLSP1_BLSP_QUP4_QUP_MX_WRITE_COUNT_ADDR A:0x678b9150
y.create.l HWIO_BLSP1_BLSP_QUP4_QUP_MX_WRITE_CNT_CURRENT_ADDR A:0x678b9154
y.create.l HWIO_BLSP1_BLSP_QUP4_QUP_MX_INPUT_COUNT_ADDR A:0x678b9200
y.create.l HWIO_BLSP1_BLSP_QUP4_QUP_MX_INPUT_CNT_CURRENT_ADDR A:0x678b9204
y.create.l HWIO_BLSP1_BLSP_QUP4_QUP_MX_READ_COUNT_ADDR A:0x678b9208
y.create.l HWIO_BLSP1_BLSP_QUP4_QUP_MX_READ_CNT_CURRENT_ADDR A:0x678b920c
y.create.l HWIO_BLSP1_BLSP_QUP4_QUP_INPUT_DEBUG_ADDR A:0x678b9210
y.create.l HWIO_BLSP1_BLSP_QUP4_QUP_INPUT_FIFO_WORD_CNT_ADDR A:0x678b9214
y.create.l HWIO_BLSP1_BLSP_QUP4_QUP_INPUT_FIFO0_ADDR A:0x678b9218
y.create.l HWIO_BLSP1_BLSP_QUP4_QUP_INPUT_FIFO1_ADDR A:0x678b921c
y.create.l HWIO_BLSP1_BLSP_QUP4_QUP_INPUT_FIFO2_ADDR A:0x678b9220
y.create.l HWIO_BLSP1_BLSP_QUP4_QUP_INPUT_FIFO3_ADDR A:0x678b9224
y.create.l HWIO_BLSP1_BLSP_QUP4_QUP_INPUT_FIFO4_ADDR A:0x678b9228
y.create.l HWIO_BLSP1_BLSP_QUP4_QUP_INPUT_FIFO5_ADDR A:0x678b922c
y.create.l HWIO_BLSP1_BLSP_QUP4_QUP_INPUT_FIFO6_ADDR A:0x678b9230
y.create.l HWIO_BLSP1_BLSP_QUP4_QUP_INPUT_FIFO7_ADDR A:0x678b9234
y.create.l HWIO_BLSP1_BLSP_QUP4_QUP_INPUT_FIFO8_ADDR A:0x678b9238
y.create.l HWIO_BLSP1_BLSP_QUP4_QUP_INPUT_FIFO9_ADDR A:0x678b923c
y.create.l HWIO_BLSP1_BLSP_QUP4_SPI_CONFIG_ADDR A:0x678b9300
y.create.l HWIO_BLSP1_BLSP_QUP4_SPI_IO_CONTROL_ADDR A:0x678b9304
y.create.l HWIO_BLSP1_BLSP_QUP4_SPI_ERROR_FLAGS_ADDR A:0x678b9308
y.create.l HWIO_BLSP1_BLSP_QUP4_SPI_ERROR_FLAGS_EN_ADDR A:0x678b930c
y.create.l HWIO_BLSP1_BLSP_QUP4_SPI_DEASSERT_WAIT_ADDR A:0x678b9310
y.create.l HWIO_BLSP1_BLSP_QUP4_SPI_MASTER_LOCAL_ID_ADDR A:0x678b9314
y.create.l HWIO_BLSP1_BLSP_QUP4_SPI_MASTER_COMMAND_ADDR A:0x678b9318
y.create.l HWIO_BLSP1_BLSP_QUP4_SPI_MASTER_STATUS_ADDR A:0x678b931c
y.create.l HWIO_BLSP1_BLSP_QUP4_SPI_CHAR_CFG_ADDR A:0x678b9320
y.create.l HWIO_BLSP1_BLSP_QUP4_SPI_CHAR_DATA_SPI_CS_ADDR A:0x678b9324
y.create.l HWIO_BLSP1_BLSP_QUP4_SPI_CHAR_DATA_SPI_MOSI_ADDR A:0x678b9328
y.create.l HWIO_BLSP1_BLSP_QUP4_SPI_CHAR_DATA_SPI_MISO_ADDR A:0x678b932c
y.create.l HWIO_BLSP1_BLSP_QUP4_SPI_SLAVE_IRQ_STATUS_ADDR A:0x678b9330
y.create.l HWIO_BLSP1_BLSP_QUP4_SPI_SLAVE_IRQ_EN_ADDR A:0x678b9334
y.create.l HWIO_BLSP1_BLSP_QUP4_SPI_SLAVE_CFG_ADDR A:0x678b9338
y.create.l HWIO_BLSP1_BLSP_QUP4_SPI_SLAVE_DEBUG_ADDR A:0x678b933c
y.create.l HWIO_BLSP1_BLSP_QUP4_I2C_MASTER_CLK_CTL_ADDR A:0x678b9400
y.create.l HWIO_BLSP1_BLSP_QUP4_I2C_MASTER_STATUS_ADDR A:0x678b9404
y.create.l HWIO_BLSP1_BLSP_QUP4_I2C_MASTER_CONFIG_ADDR A:0x678b9408
y.create.l HWIO_BLSP1_BLSP_QUP4_I2C_MASTER_BUS_CLEAR_ADDR A:0x678b940c
y.create.l HWIO_BLSP1_BLSP_QUP4_I2C_MASTER_LOCAL_ID_ADDR A:0x678b9410
y.create.l HWIO_BLSP1_BLSP_QUP4_I2C_MASTER_COMMAND_ADDR A:0x678b9414
y.create.l HWIO_BLSP1_BLSP_QUP5_QUP_CONFIG_ADDR A:0x678ba000
y.create.l HWIO_BLSP1_BLSP_QUP5_QUP_STATE_ADDR A:0x678ba004
y.create.l HWIO_BLSP1_BLSP_QUP5_QUP_IO_MODES_ADDR A:0x678ba008
y.create.l HWIO_BLSP1_BLSP_QUP5_QUP_SW_RESET_ADDR A:0x678ba00c
y.create.l HWIO_BLSP1_BLSP_QUP5_QUP_TRANSFER_CANCEL_ADDR A:0x678ba014
y.create.l HWIO_BLSP1_BLSP_QUP5_QUP_OPERATIONAL_ADDR A:0x678ba018
y.create.l HWIO_BLSP1_BLSP_QUP5_QUP_ERROR_FLAGS_ADDR A:0x678ba01c
y.create.l HWIO_BLSP1_BLSP_QUP5_QUP_ERROR_FLAGS_EN_ADDR A:0x678ba020
y.create.l HWIO_BLSP1_BLSP_QUP5_QUP_TEST_CTRL_ADDR A:0x678ba024
y.create.l HWIO_BLSP1_BLSP_QUP5_QUP_OPERATIONAL_MASK_ADDR A:0x678ba028
y.create.l HWIO_BLSP1_BLSP_QUP5_QUP_HW_VERSION_ADDR A:0x678ba030
y.create.l HWIO_BLSP1_BLSP_QUP5_QUP_MX_OUTPUT_COUNT_ADDR A:0x678ba100
y.create.l HWIO_BLSP1_BLSP_QUP5_QUP_MX_OUTPUT_CNT_CURRENT_ADDR A:0x678ba104
y.create.l HWIO_BLSP1_BLSP_QUP5_QUP_OUTPUT_DEBUG_ADDR A:0x678ba108
y.create.l HWIO_BLSP1_BLSP_QUP5_QUP_OUTPUT_FIFO_WORD_CNT_ADDR A:0x678ba10c
y.create.l HWIO_BLSP1_BLSP_QUP5_QUP_OUTPUT_FIFO0_ADDR A:0x678ba110
y.create.l HWIO_BLSP1_BLSP_QUP5_QUP_OUTPUT_FIFO1_ADDR A:0x678ba114
y.create.l HWIO_BLSP1_BLSP_QUP5_QUP_OUTPUT_FIFO2_ADDR A:0x678ba118
y.create.l HWIO_BLSP1_BLSP_QUP5_QUP_OUTPUT_FIFO3_ADDR A:0x678ba11c
y.create.l HWIO_BLSP1_BLSP_QUP5_QUP_OUTPUT_FIFO4_ADDR A:0x678ba120
y.create.l HWIO_BLSP1_BLSP_QUP5_QUP_OUTPUT_FIFO5_ADDR A:0x678ba124
y.create.l HWIO_BLSP1_BLSP_QUP5_QUP_OUTPUT_FIFO6_ADDR A:0x678ba128
y.create.l HWIO_BLSP1_BLSP_QUP5_QUP_OUTPUT_FIFO7_ADDR A:0x678ba12c
y.create.l HWIO_BLSP1_BLSP_QUP5_QUP_OUTPUT_FIFO8_ADDR A:0x678ba130
y.create.l HWIO_BLSP1_BLSP_QUP5_QUP_OUTPUT_FIFO9_ADDR A:0x678ba134
y.create.l HWIO_BLSP1_BLSP_QUP5_QUP_MX_WRITE_COUNT_ADDR A:0x678ba150
y.create.l HWIO_BLSP1_BLSP_QUP5_QUP_MX_WRITE_CNT_CURRENT_ADDR A:0x678ba154
y.create.l HWIO_BLSP1_BLSP_QUP5_QUP_MX_INPUT_COUNT_ADDR A:0x678ba200
y.create.l HWIO_BLSP1_BLSP_QUP5_QUP_MX_INPUT_CNT_CURRENT_ADDR A:0x678ba204
y.create.l HWIO_BLSP1_BLSP_QUP5_QUP_MX_READ_COUNT_ADDR A:0x678ba208
y.create.l HWIO_BLSP1_BLSP_QUP5_QUP_MX_READ_CNT_CURRENT_ADDR A:0x678ba20c
y.create.l HWIO_BLSP1_BLSP_QUP5_QUP_INPUT_DEBUG_ADDR A:0x678ba210
y.create.l HWIO_BLSP1_BLSP_QUP5_QUP_INPUT_FIFO_WORD_CNT_ADDR A:0x678ba214
y.create.l HWIO_BLSP1_BLSP_QUP5_QUP_INPUT_FIFO0_ADDR A:0x678ba218
y.create.l HWIO_BLSP1_BLSP_QUP5_QUP_INPUT_FIFO1_ADDR A:0x678ba21c
y.create.l HWIO_BLSP1_BLSP_QUP5_QUP_INPUT_FIFO2_ADDR A:0x678ba220
y.create.l HWIO_BLSP1_BLSP_QUP5_QUP_INPUT_FIFO3_ADDR A:0x678ba224
y.create.l HWIO_BLSP1_BLSP_QUP5_QUP_INPUT_FIFO4_ADDR A:0x678ba228
y.create.l HWIO_BLSP1_BLSP_QUP5_QUP_INPUT_FIFO5_ADDR A:0x678ba22c
y.create.l HWIO_BLSP1_BLSP_QUP5_QUP_INPUT_FIFO6_ADDR A:0x678ba230
y.create.l HWIO_BLSP1_BLSP_QUP5_QUP_INPUT_FIFO7_ADDR A:0x678ba234
y.create.l HWIO_BLSP1_BLSP_QUP5_QUP_INPUT_FIFO8_ADDR A:0x678ba238
y.create.l HWIO_BLSP1_BLSP_QUP5_QUP_INPUT_FIFO9_ADDR A:0x678ba23c
y.create.l HWIO_BLSP1_BLSP_QUP5_SPI_CONFIG_ADDR A:0x678ba300
y.create.l HWIO_BLSP1_BLSP_QUP5_SPI_IO_CONTROL_ADDR A:0x678ba304
y.create.l HWIO_BLSP1_BLSP_QUP5_SPI_ERROR_FLAGS_ADDR A:0x678ba308
y.create.l HWIO_BLSP1_BLSP_QUP5_SPI_ERROR_FLAGS_EN_ADDR A:0x678ba30c
y.create.l HWIO_BLSP1_BLSP_QUP5_SPI_DEASSERT_WAIT_ADDR A:0x678ba310
y.create.l HWIO_BLSP1_BLSP_QUP5_SPI_MASTER_LOCAL_ID_ADDR A:0x678ba314
y.create.l HWIO_BLSP1_BLSP_QUP5_SPI_MASTER_COMMAND_ADDR A:0x678ba318
y.create.l HWIO_BLSP1_BLSP_QUP5_SPI_MASTER_STATUS_ADDR A:0x678ba31c
y.create.l HWIO_BLSP1_BLSP_QUP5_SPI_CHAR_CFG_ADDR A:0x678ba320
y.create.l HWIO_BLSP1_BLSP_QUP5_SPI_CHAR_DATA_SPI_CS_ADDR A:0x678ba324
y.create.l HWIO_BLSP1_BLSP_QUP5_SPI_CHAR_DATA_SPI_MOSI_ADDR A:0x678ba328
y.create.l HWIO_BLSP1_BLSP_QUP5_SPI_CHAR_DATA_SPI_MISO_ADDR A:0x678ba32c
y.create.l HWIO_BLSP1_BLSP_QUP5_SPI_SLAVE_IRQ_STATUS_ADDR A:0x678ba330
y.create.l HWIO_BLSP1_BLSP_QUP5_SPI_SLAVE_IRQ_EN_ADDR A:0x678ba334
y.create.l HWIO_BLSP1_BLSP_QUP5_SPI_SLAVE_CFG_ADDR A:0x678ba338
y.create.l HWIO_BLSP1_BLSP_QUP5_SPI_SLAVE_DEBUG_ADDR A:0x678ba33c
y.create.l HWIO_BLSP1_BLSP_QUP5_I2C_MASTER_CLK_CTL_ADDR A:0x678ba400
y.create.l HWIO_BLSP1_BLSP_QUP5_I2C_MASTER_STATUS_ADDR A:0x678ba404
y.create.l HWIO_BLSP1_BLSP_QUP5_I2C_MASTER_CONFIG_ADDR A:0x678ba408
y.create.l HWIO_BLSP1_BLSP_QUP5_I2C_MASTER_BUS_CLEAR_ADDR A:0x678ba40c
y.create.l HWIO_BLSP1_BLSP_QUP5_I2C_MASTER_LOCAL_ID_ADDR A:0x678ba410
y.create.l HWIO_BLSP1_BLSP_QUP5_I2C_MASTER_COMMAND_ADDR A:0x678ba414
y.create.l HWIO_BOOT_ROM_XPU_SCR_ADDR A:0x601ff000
y.create.l HWIO_BOOT_ROM_XPU_SWDR_ADDR A:0x601ff004
y.create.l HWIO_BOOT_ROM_XPU_PRTN_RACR_SSHADOW_ADDR A:0x601ff008
y.create.l HWIO_BOOT_ROM_XPU_PRTN_START_SSHADOW0_ADDR A:0x601ff010
y.create.l HWIO_BOOT_ROM_XPU_PRTN_END_SSHADOW0_ADDR A:0x601ff018
y.create.l HWIO_BOOT_ROM_XPU_SEAR0_ADDR A:0x601ff040
y.create.l HWIO_BOOT_ROM_XPU_SESR_ADDR A:0x601ff048
y.create.l HWIO_BOOT_ROM_XPU_SESRRESTORE_ADDR A:0x601ff04c
y.create.l HWIO_BOOT_ROM_XPU_SESYNR0_ADDR A:0x601ff050
y.create.l HWIO_BOOT_ROM_XPU_SESYNR1_ADDR A:0x601ff054
y.create.l HWIO_BOOT_ROM_XPU_SESYNR2_ADDR A:0x601ff058
y.create.l HWIO_BOOT_ROM_XPU_MCR_ADDR A:0x601ff100
y.create.l HWIO_BOOT_ROM_XPU_MEAR0_ADDR A:0x601ff140
y.create.l HWIO_BOOT_ROM_XPU_MESR_ADDR A:0x601ff148
y.create.l HWIO_BOOT_ROM_XPU_MESRRESTORE_ADDR A:0x601ff14c
y.create.l HWIO_BOOT_ROM_XPU_MESYNR0_ADDR A:0x601ff150
y.create.l HWIO_BOOT_ROM_XPU_MESYNR1_ADDR A:0x601ff154
y.create.l HWIO_BOOT_ROM_XPU_MESYNR2_ADDR A:0x601ff158
y.create.l HWIO_BOOT_ROM_XPU_CR_ADDR A:0x601ff080
y.create.l HWIO_BOOT_ROM_XPU_PRTN_RACR_SHADOW_ADDR A:0x601ff088
y.create.l HWIO_BOOT_ROM_XPU_PRTN_START_SHADOW0_ADDR A:0x601ff090
y.create.l HWIO_BOOT_ROM_XPU_PRTN_END_SHADOW0_ADDR A:0x601ff098
y.create.l HWIO_BOOT_ROM_XPU_RPU_ACR0_ADDR A:0x601ff0a0
y.create.l HWIO_BOOT_ROM_XPU_EAR0_ADDR A:0x601ff0c0
y.create.l HWIO_BOOT_ROM_XPU_ESR_ADDR A:0x601ff0c8
y.create.l HWIO_BOOT_ROM_XPU_ESRRESTORE_ADDR A:0x601ff0cc
y.create.l HWIO_BOOT_ROM_XPU_ESYNR0_ADDR A:0x601ff0d0
y.create.l HWIO_BOOT_ROM_XPU_ESYNR1_ADDR A:0x601ff0d4
y.create.l HWIO_BOOT_ROM_XPU_ESYNR2_ADDR A:0x601ff0d8
y.create.l HWIO_BOOT_ROM_XPU_UMR_RACR_ADDR A:0x601ff0e0
y.create.l HWIO_BOOT_ROM_XPU_UMR_WACR_ADDR A:0x601ff0e4
y.create.l HWIO_BOOT_ROM_XPU_UMR_CNTL_ADDR A:0x601ff0f0
y.create.l HWIO_BOOT_ROM_XPU_IDR0_ADDR A:0x601ff074
y.create.l HWIO_BOOT_ROM_XPU_IDR1_ADDR A:0x601ff078
y.create.l HWIO_BOOT_ROM_XPU_REV_ADDR A:0x601ff07c
y.create.l HWIO_BOOT_ROM_XPU_PRT0_RACR0_ADDR A:0x601ff200
y.create.l HWIO_BOOT_ROM_XPU_PRT1_RACR0_ADDR A:0x601ff280
y.create.l HWIO_BOOT_ROM_XPU_PRT2_RACR0_ADDR A:0x601ff300
y.create.l HWIO_BOOT_ROM_XPU_PRT0_START0_ADDR A:0x601ff240
y.create.l HWIO_BOOT_ROM_XPU_PRT1_START0_ADDR A:0x601ff2c0
y.create.l HWIO_BOOT_ROM_XPU_PRT2_START0_ADDR A:0x601ff340
y.create.l HWIO_BOOT_ROM_XPU_PRT0_END0_ADDR A:0x601ff248
y.create.l HWIO_BOOT_ROM_XPU_PRT1_END0_ADDR A:0x601ff2c8
y.create.l HWIO_BOOT_ROM_XPU_PRT2_END0_ADDR A:0x601ff348
y.create.l HWIO_BOOT_ROM_XPU_PRT0_SCR_ADDR A:0x601ff250
y.create.l HWIO_BOOT_ROM_XPU_PRT1_SCR_ADDR A:0x601ff2d0
y.create.l HWIO_BOOT_ROM_XPU_PRT2_SCR_ADDR A:0x601ff350
y.create.l HWIO_BOOT_ROM_XPU_PRT0_MCR_ADDR A:0x601ff254
y.create.l HWIO_BOOT_ROM_XPU_PRT1_MCR_ADDR A:0x601ff2d4
y.create.l HWIO_BOOT_ROM_XPU_PRT2_MCR_ADDR A:0x601ff354
y.create.l HWIO_BOOT_ROM_XPU_PRT0_CNTL0_ADDR A:0x601ff258
y.create.l HWIO_BOOT_ROM_XPU_PRT1_CNTL0_ADDR A:0x601ff2d8
y.create.l HWIO_BOOT_ROM_XPU_PRT2_CNTL0_ADDR A:0x601ff358
y.create.l HWIO_BOOT_ROM_XPU_PRT0_CNTL1_ADDR A:0x601ff25c
y.create.l HWIO_BOOT_ROM_XPU_PRT1_CNTL1_ADDR A:0x601ff2dc
y.create.l HWIO_BOOT_ROM_XPU_PRT2_CNTL1_ADDR A:0x601ff35c
y.create.l HWIO_GCC_GPLL0_MODE_ADDR A:0x61821000
y.create.l HWIO_GCC_GPLL0_L_VAL_ADDR A:0x61821004
y.create.l HWIO_GCC_GPLL0_ALPHA_VAL_ADDR A:0x61821008
y.create.l HWIO_GCC_GPLL0_ALPHA_VAL_U_ADDR A:0x6182100c
y.create.l HWIO_GCC_GPLL0_USER_CTL_ADDR A:0x61821010
y.create.l HWIO_GCC_GPLL0_USER_CTL_U_ADDR A:0x61821014
y.create.l HWIO_GCC_GPLL0_CONFIG_CTL_ADDR A:0x61821018
y.create.l HWIO_GCC_GPLL0_TEST_CTL_ADDR A:0x6182101c
y.create.l HWIO_GCC_GPLL0_TEST_CTL_U_ADDR A:0x61821020
y.create.l HWIO_GCC_GPLL0_STATUS_ADDR A:0x61821024
y.create.l HWIO_GCC_GPLL0_FREQ_CTL_ADDR A:0x61821028
y.create.l HWIO_GCC_GPLL0_SSC_UPDATE_RATE_ADDR A:0x6182102c
y.create.l HWIO_GCC_GPLL0_SSC_DELTA_ALPHA_ADDR A:0x61821030
y.create.l HWIO_GCC_GPLL0_SSC_NUM_STEPS_ADDR A:0x61821034
y.create.l HWIO_GCC_GPLL1_MODE_ADDR A:0x61820000
y.create.l HWIO_GCC_GPLL1_L_VAL_ADDR A:0x61820004
y.create.l HWIO_GCC_GPLL1_M_VAL_ADDR A:0x61820008
y.create.l HWIO_GCC_GPLL1_N_VAL_ADDR A:0x6182000c
y.create.l HWIO_GCC_GPLL1_USER_CTL_ADDR A:0x61820010
y.create.l HWIO_GCC_GPLL1_CONFIG_CTL_ADDR A:0x61820014
y.create.l HWIO_GCC_GPLL1_TEST_CTL_ADDR A:0x61820018
y.create.l HWIO_GCC_GPLL1_STATUS_ADDR A:0x6182001c
y.create.l HWIO_GCC_GPLL2_MODE_ADDR A:0x61825000
y.create.l HWIO_GCC_GPLL2_L_VAL_ADDR A:0x61825004
y.create.l HWIO_GCC_GPLL2_ALPHA_VAL_ADDR A:0x61825008
y.create.l HWIO_GCC_GPLL2_ALPHA_VAL_U_ADDR A:0x6182500c
y.create.l HWIO_GCC_GPLL2_USER_CTL_ADDR A:0x61825010
y.create.l HWIO_GCC_GPLL2_USER_CTL_U_ADDR A:0x61825014
y.create.l HWIO_GCC_GPLL2_CONFIG_CTL_ADDR A:0x61825018
y.create.l HWIO_GCC_GPLL2_TEST_CTL_ADDR A:0x6182501c
y.create.l HWIO_GCC_GPLL2_TEST_CTL_U_ADDR A:0x61825020
y.create.l HWIO_GCC_GPLL2_STATUS_ADDR A:0x61825024
y.create.l HWIO_GCC_GPLL2_FREQ_CTL_ADDR A:0x61825028
y.create.l HWIO_GCC_GPLL2_SSC_UPDATE_RATE_ADDR A:0x6182502c
y.create.l HWIO_GCC_GPLL2_SSC_DELTA_ALPHA_ADDR A:0x61825030
y.create.l HWIO_GCC_GPLL2_SSC_NUM_STEPS_ADDR A:0x61825034
y.create.l HWIO_GCC_BIMC_PLL_MODE_ADDR A:0x61823000
y.create.l HWIO_GCC_BIMC_PLL_L_VAL_ADDR A:0x61823004
y.create.l HWIO_GCC_BIMC_PLL_ALPHA_VAL_ADDR A:0x61823008
y.create.l HWIO_GCC_BIMC_PLL_ALPHA_VAL_U_ADDR A:0x6182300c
y.create.l HWIO_GCC_BIMC_PLL_USER_CTL_ADDR A:0x61823010
y.create.l HWIO_GCC_BIMC_PLL_USER_CTL_U_ADDR A:0x61823014
y.create.l HWIO_GCC_BIMC_PLL_CONFIG_CTL_ADDR A:0x61823018
y.create.l HWIO_GCC_BIMC_PLL_TEST_CTL_ADDR A:0x6182301c
y.create.l HWIO_GCC_BIMC_PLL_TEST_CTL_U_ADDR A:0x61823020
y.create.l HWIO_GCC_BIMC_PLL_STATUS_ADDR A:0x61823024
y.create.l HWIO_GCC_BIMC_PLL_FREQ_CTL_ADDR A:0x61823028
y.create.l HWIO_GCC_BIMC_PLL_SSC_UPDATE_RATE_ADDR A:0x6182302c
y.create.l HWIO_GCC_BIMC_PLL_SSC_DELTA_ALPHA_ADDR A:0x61823030
y.create.l HWIO_GCC_BIMC_PLL_SSC_NUM_STEPS_ADDR A:0x61823034
y.create.l HWIO_GCC_PCNOC_BFDCD_CMD_RCGR_ADDR A:0x61827000
y.create.l HWIO_GCC_PCNOC_BFDCD_CFG_RCGR_ADDR A:0x61827004
y.create.l HWIO_GCC_PCNOC_BCR_ADDR A:0x61827018
y.create.l HWIO_GCC_PCNOC_AHB_CBCR_ADDR A:0x6182701c
y.create.l HWIO_GCC_PCNOC_DDR_CFG_CBCR_ADDR A:0x61832024
y.create.l HWIO_GCC_PCNOC_RPM_AHB_CBCR_ADDR A:0x61827024
y.create.l HWIO_GCC_PCNOC_AT_CBCR_ADDR A:0x61827028
y.create.l HWIO_GCC_PCNOC_QDSS_STM_AXI_CBCR_ADDR A:0x6182702c
y.create.l HWIO_GCC_PCNOC_APSS_AHB_CBCR_ADDR A:0x61827030
y.create.l HWIO_GCC_NOC_CONF_XPU_AHB_CBCR_ADDR A:0x61817000
y.create.l HWIO_GCC_IMEM_BCR_ADDR A:0x6180e000
y.create.l HWIO_GCC_IMEM_AXI_CBCR_ADDR A:0x6180e004
y.create.l HWIO_GCC_IMEM_CFG_AHB_CBCR_ADDR A:0x6180e008
y.create.l HWIO_GCC_MSS_CFG_AHB_CBCR_ADDR A:0x61849000
y.create.l HWIO_GCC_MSS_Q6_BIMC_AXI_CBCR_ADDR A:0x61849004
y.create.l HWIO_GCC_RPM_CFG_XPU_CBCR_ADDR A:0x61817004
y.create.l HWIO_GCC_QDSS_BCR_ADDR A:0x61829000
y.create.l HWIO_GCC_QDSS_DAP_AHB_CBCR_ADDR A:0x61829004
y.create.l HWIO_GCC_QDSS_CFG_AHB_CBCR_ADDR A:0x61829008
y.create.l HWIO_GCC_QDSS_AT_CMD_RCGR_ADDR A:0x6182900c
y.create.l HWIO_GCC_QDSS_AT_CFG_RCGR_ADDR A:0x61829010
y.create.l HWIO_GCC_QDSS_AT_CBCR_ADDR A:0x61829024
y.create.l HWIO_GCC_QDSS_ETR_USB_CBCR_ADDR A:0x61829028
y.create.l HWIO_GCC_QDSS_STM_CMD_RCGR_ADDR A:0x6182902c
y.create.l HWIO_GCC_QDSS_STM_CFG_RCGR_ADDR A:0x61829030
y.create.l HWIO_GCC_QDSS_STM_CBCR_ADDR A:0x61829044
y.create.l HWIO_GCC_QDSS_TRACECLKIN_CMD_RCGR_ADDR A:0x61829048
y.create.l HWIO_GCC_QDSS_TRACECLKIN_CFG_RCGR_ADDR A:0x6182904c
y.create.l HWIO_GCC_QDSS_TRACECLKIN_CBCR_ADDR A:0x61829060
y.create.l HWIO_GCC_QDSS_TSCTR_CMD_RCGR_ADDR A:0x61829064
y.create.l HWIO_GCC_QDSS_TSCTR_CFG_RCGR_ADDR A:0x61829068
y.create.l HWIO_GCC_QDSS_TSCTR_DIV2_CBCR_ADDR A:0x6182907c
y.create.l HWIO_GCC_QDSS_TSCTR_DIV3_CBCR_ADDR A:0x61829080
y.create.l HWIO_GCC_QDSS_DAP_CBCR_ADDR A:0x61829084
y.create.l HWIO_GCC_QDSS_TSCTR_DIV4_CBCR_ADDR A:0x61829088
y.create.l HWIO_GCC_QDSS_TSCTR_DIV8_CBCR_ADDR A:0x6182908c
y.create.l HWIO_GCC_QDSS_TSCTR_DIV16_CBCR_ADDR A:0x61829090
y.create.l HWIO_GCC_QPIC_BCR_ADDR A:0x6183f000
y.create.l HWIO_GCC_QPIC_CMD_RCGR_ADDR A:0x6183f004
y.create.l HWIO_GCC_QPIC_CFG_RCGR_ADDR A:0x6183f008
y.create.l HWIO_GCC_QPIC_M_ADDR A:0x6183f00c
y.create.l HWIO_GCC_QPIC_N_ADDR A:0x6183f010
y.create.l HWIO_GCC_QPIC_D_ADDR A:0x6183f014
y.create.l HWIO_GCC_QPIC_CBCR_ADDR A:0x6183f018
y.create.l HWIO_GCC_QPIC_AHB_CBCR_ADDR A:0x6183f01c
y.create.l HWIO_GCC_QPIC_SYSTEM_CBCR_ADDR A:0x6183f020
y.create.l HWIO_GCC_GCC_SLEEP_CMD_RCGR_ADDR A:0x61830000
y.create.l HWIO_GCC_USB_HS_BCR_ADDR A:0x61841000
y.create.l HWIO_GCC_USB_HS_SYSTEM_CBCR_ADDR A:0x61841004
y.create.l HWIO_GCC_USB_HS_AHB_CBCR_ADDR A:0x61841008
y.create.l HWIO_GCC_USB_HS_PHY_CFG_AHB_CBCR_ADDR A:0x61841030
y.create.l HWIO_GCC_USB_HS_INACTIVITY_TIMERS_CBCR_ADDR A:0x6184100c
y.create.l HWIO_GCC_USB_HSIC_SYSTEM_CBCR_ADDR A:0x6183d048
y.create.l HWIO_GCC_USB_HSIC_AHB_CBCR_ADDR A:0x6183d04c
y.create.l HWIO_GCC_USB_HSIC_CBCR_ADDR A:0x6183d050
y.create.l HWIO_GCC_USB_HSIC_IO_CAL_CBCR_ADDR A:0x6183d054
y.create.l HWIO_GCC_USB_HSIC_IO_CAL_SLEEP_CBCR_ADDR A:0x6183d058
y.create.l HWIO_GCC_BIMC_MCDMA_AXI_CBCR_ADDR A:0x61831048
y.create.l HWIO_GCC_BIMC_NAV_AXI_CBCR_ADDR A:0x6183104c
y.create.l HWIO_GCC_USB_HS_SYSTEM_CMD_RCGR_ADDR A:0x61841010
y.create.l HWIO_GCC_USB_HS_SYSTEM_CFG_RCGR_ADDR A:0x61841014
y.create.l HWIO_GCC_USB_HSIC_SYSTEM_CMD_RCGR_ADDR A:0x6183d000
y.create.l HWIO_GCC_USB_HSIC_SYSTEM_CFG_RCGR_ADDR A:0x6183d004
y.create.l HWIO_GCC_USB_HSIC_CMD_RCGR_ADDR A:0x6183d018
y.create.l HWIO_GCC_USB_HSIC_CFG_RCGR_ADDR A:0x6183d01c
y.create.l HWIO_GCC_USB_HSIC_IO_CAL_CMD_RCGR_ADDR A:0x6183d030
y.create.l HWIO_GCC_USB_HSIC_IO_CAL_CFG_RCGR_ADDR A:0x6183d034
y.create.l HWIO_GCC_USB_HS_HSIC_BCR_ADDR A:0x6183d05c
y.create.l HWIO_GCC_USB2A_PHY_BCR_ADDR A:0x61841028
y.create.l HWIO_GCC_USB2_HS_PHY_ONLY_BCR_ADDR A:0x61841034
y.create.l HWIO_GCC_USB_HS_PHY_CFG_AHB_BCR_ADDR A:0x61841038
y.create.l HWIO_GCC_QUSB2_PHY_BCR_ADDR A:0x6184103c
y.create.l HWIO_GCC_USB2A_PHY_SLEEP_CBCR_ADDR A:0x6184102c
y.create.l HWIO_GCC_SDCC1_BCR_ADDR A:0x61842000
y.create.l HWIO_GCC_SDCC1_APPS_CMD_RCGR_ADDR A:0x61842004
y.create.l HWIO_GCC_SDCC1_APPS_CFG_RCGR_ADDR A:0x61842008
y.create.l HWIO_GCC_SDCC1_APPS_M_ADDR A:0x6184200c
y.create.l HWIO_GCC_SDCC1_APPS_N_ADDR A:0x61842010
y.create.l HWIO_GCC_SDCC1_APPS_D_ADDR A:0x61842014
y.create.l HWIO_GCC_SDCC1_APPS_CBCR_ADDR A:0x61842018
y.create.l HWIO_GCC_SDCC1_AHB_CBCR_ADDR A:0x6184201c
y.create.l HWIO_GCC_SDCC1_MISC_ADDR A:0x61842020
y.create.l HWIO_GCC_SDCC2_BCR_ADDR A:0x61843000
y.create.l HWIO_GCC_SDCC2_APPS_CMD_RCGR_ADDR A:0x61843004
y.create.l HWIO_GCC_SDCC2_APPS_CFG_RCGR_ADDR A:0x61843008
y.create.l HWIO_GCC_SDCC2_APPS_M_ADDR A:0x6184300c
y.create.l HWIO_GCC_SDCC2_APPS_N_ADDR A:0x61843010
y.create.l HWIO_GCC_SDCC2_APPS_D_ADDR A:0x61843014
y.create.l HWIO_GCC_SDCC2_APPS_CBCR_ADDR A:0x61843018
y.create.l HWIO_GCC_SDCC2_AHB_CBCR_ADDR A:0x6184301c
y.create.l HWIO_GCC_BLSP1_BCR_ADDR A:0x61801000
y.create.l HWIO_GCC_BLSP1_SLEEP_CBCR_ADDR A:0x61801004
y.create.l HWIO_GCC_BLSP1_AHB_CBCR_ADDR A:0x61801008
y.create.l HWIO_GCC_BLSP1_QUP1_BCR_ADDR A:0x61802000
y.create.l HWIO_GCC_BLSP1_QUP1_SPI_APPS_CBCR_ADDR A:0x61802004
y.create.l HWIO_GCC_BLSP1_QUP1_I2C_APPS_CBCR_ADDR A:0x61802008
y.create.l HWIO_GCC_BLSP1_QUP1_I2C_APPS_CMD_RCGR_ADDR A:0x6180200c
y.create.l HWIO_GCC_BLSP1_QUP1_I2C_APPS_CFG_RCGR_ADDR A:0x61802010
y.create.l HWIO_GCC_BLSP1_QUP2_I2C_APPS_CMD_RCGR_ADDR A:0x61803000
y.create.l HWIO_GCC_BLSP1_QUP2_I2C_APPS_CFG_RCGR_ADDR A:0x61803004
y.create.l HWIO_GCC_BLSP1_QUP3_I2C_APPS_CMD_RCGR_ADDR A:0x61804000
y.create.l HWIO_GCC_BLSP1_QUP3_I2C_APPS_CFG_RCGR_ADDR A:0x61804004
y.create.l HWIO_GCC_BLSP1_QUP4_I2C_APPS_CMD_RCGR_ADDR A:0x61805000
y.create.l HWIO_GCC_BLSP1_QUP4_I2C_APPS_CFG_RCGR_ADDR A:0x61805004
y.create.l HWIO_GCC_BLSP1_QUP5_I2C_APPS_CMD_RCGR_ADDR A:0x61806000
y.create.l HWIO_GCC_BLSP1_QUP5_I2C_APPS_CFG_RCGR_ADDR A:0x61806004
y.create.l HWIO_GCC_BLSP1_QUP6_I2C_APPS_CMD_RCGR_ADDR A:0x61807000
y.create.l HWIO_GCC_BLSP1_QUP6_I2C_APPS_CFG_RCGR_ADDR A:0x61807004
y.create.l HWIO_GCC_BLSP1_QUP1_SPI_APPS_CMD_RCGR_ADDR A:0x61802024
y.create.l HWIO_GCC_BLSP1_QUP1_SPI_APPS_CFG_RCGR_ADDR A:0x61802028
y.create.l HWIO_GCC_BLSP1_QUP1_SPI_APPS_M_ADDR A:0x6180202c
y.create.l HWIO_GCC_BLSP1_QUP1_SPI_APPS_N_ADDR A:0x61802030
y.create.l HWIO_GCC_BLSP1_QUP1_SPI_APPS_D_ADDR A:0x61802034
y.create.l HWIO_GCC_BLSP1_UART1_BCR_ADDR A:0x61802038
y.create.l HWIO_GCC_BLSP1_UART1_APPS_CBCR_ADDR A:0x6180203c
y.create.l HWIO_GCC_BLSP1_UART1_SIM_CBCR_ADDR A:0x61802040
y.create.l HWIO_GCC_BLSP1_UART1_APPS_CMD_RCGR_ADDR A:0x61802044
y.create.l HWIO_GCC_BLSP1_UART1_APPS_CFG_RCGR_ADDR A:0x61802048
y.create.l HWIO_GCC_BLSP1_UART1_APPS_M_ADDR A:0x6180204c
y.create.l HWIO_GCC_BLSP1_UART1_APPS_N_ADDR A:0x61802050
y.create.l HWIO_GCC_BLSP1_UART1_APPS_D_ADDR A:0x61802054
y.create.l HWIO_GCC_BLSP1_QUP2_BCR_ADDR A:0x61803008
y.create.l HWIO_GCC_BLSP1_QUP2_SPI_APPS_CBCR_ADDR A:0x6180300c
y.create.l HWIO_GCC_BLSP1_QUP2_I2C_APPS_CBCR_ADDR A:0x61803010
y.create.l HWIO_GCC_BLSP1_QUP2_SPI_APPS_CMD_RCGR_ADDR A:0x61803014
y.create.l HWIO_GCC_BLSP1_QUP2_SPI_APPS_CFG_RCGR_ADDR A:0x61803018
y.create.l HWIO_GCC_BLSP1_QUP2_SPI_APPS_M_ADDR A:0x6180301c
y.create.l HWIO_GCC_BLSP1_QUP2_SPI_APPS_N_ADDR A:0x61803020
y.create.l HWIO_GCC_BLSP1_QUP2_SPI_APPS_D_ADDR A:0x61803024
y.create.l HWIO_GCC_BLSP1_UART2_BCR_ADDR A:0x61803028
y.create.l HWIO_GCC_BLSP1_UART2_APPS_CBCR_ADDR A:0x6180302c
y.create.l HWIO_GCC_BLSP1_UART2_SIM_CBCR_ADDR A:0x61803030
y.create.l HWIO_GCC_BLSP1_UART2_APPS_CMD_RCGR_ADDR A:0x61803034
y.create.l HWIO_GCC_BLSP1_UART2_APPS_CFG_RCGR_ADDR A:0x61803038
y.create.l HWIO_GCC_BLSP1_UART2_APPS_M_ADDR A:0x6180303c
y.create.l HWIO_GCC_BLSP1_UART2_APPS_N_ADDR A:0x61803040
y.create.l HWIO_GCC_BLSP1_UART2_APPS_D_ADDR A:0x61803044
y.create.l HWIO_GCC_BLSP1_QUP3_BCR_ADDR A:0x61804018
y.create.l HWIO_GCC_BLSP1_QUP3_SPI_APPS_CBCR_ADDR A:0x6180401c
y.create.l HWIO_GCC_BLSP1_QUP3_I2C_APPS_CBCR_ADDR A:0x61804020
y.create.l HWIO_GCC_BLSP1_QUP3_SPI_APPS_CMD_RCGR_ADDR A:0x61804024
y.create.l HWIO_GCC_BLSP1_QUP3_SPI_APPS_CFG_RCGR_ADDR A:0x61804028
y.create.l HWIO_GCC_BLSP1_QUP3_SPI_APPS_M_ADDR A:0x6180402c
y.create.l HWIO_GCC_BLSP1_QUP3_SPI_APPS_N_ADDR A:0x61804030
y.create.l HWIO_GCC_BLSP1_QUP3_SPI_APPS_D_ADDR A:0x61804034
y.create.l HWIO_GCC_BLSP1_UART3_BCR_ADDR A:0x61804038
y.create.l HWIO_GCC_BLSP1_UART3_APPS_CBCR_ADDR A:0x6180403c
y.create.l HWIO_GCC_BLSP1_UART3_SIM_CBCR_ADDR A:0x61804040
y.create.l HWIO_GCC_BLSP1_UART3_APPS_CMD_RCGR_ADDR A:0x61804044
y.create.l HWIO_GCC_BLSP1_UART3_APPS_CFG_RCGR_ADDR A:0x61804048
y.create.l HWIO_GCC_BLSP1_UART3_APPS_M_ADDR A:0x6180404c
y.create.l HWIO_GCC_BLSP1_UART3_APPS_N_ADDR A:0x61804050
y.create.l HWIO_GCC_BLSP1_UART3_APPS_D_ADDR A:0x61804054
y.create.l HWIO_GCC_BLSP1_QUP4_BCR_ADDR A:0x61805018
y.create.l HWIO_GCC_BLSP1_QUP4_SPI_APPS_CBCR_ADDR A:0x6180501c
y.create.l HWIO_GCC_BLSP1_QUP4_I2C_APPS_CBCR_ADDR A:0x61805020
y.create.l HWIO_GCC_BLSP1_QUP4_SPI_APPS_CMD_RCGR_ADDR A:0x61805024
y.create.l HWIO_GCC_BLSP1_QUP4_SPI_APPS_CFG_RCGR_ADDR A:0x61805028
y.create.l HWIO_GCC_BLSP1_QUP4_SPI_APPS_M_ADDR A:0x6180502c
y.create.l HWIO_GCC_BLSP1_QUP4_SPI_APPS_N_ADDR A:0x61805030
y.create.l HWIO_GCC_BLSP1_QUP4_SPI_APPS_D_ADDR A:0x61805034
y.create.l HWIO_GCC_BLSP1_UART4_BCR_ADDR A:0x61805038
y.create.l HWIO_GCC_BLSP1_UART4_APPS_CBCR_ADDR A:0x6180503c
y.create.l HWIO_GCC_BLSP1_UART4_SIM_CBCR_ADDR A:0x61805040
y.create.l HWIO_GCC_BLSP1_UART4_APPS_CMD_RCGR_ADDR A:0x61805044
y.create.l HWIO_GCC_BLSP1_UART4_APPS_CFG_RCGR_ADDR A:0x61805048
y.create.l HWIO_GCC_BLSP1_UART4_APPS_M_ADDR A:0x6180504c
y.create.l HWIO_GCC_BLSP1_UART4_APPS_N_ADDR A:0x61805050
y.create.l HWIO_GCC_BLSP1_UART4_APPS_D_ADDR A:0x61805054
y.create.l HWIO_GCC_BLSP1_QUP5_BCR_ADDR A:0x61806018
y.create.l HWIO_GCC_BLSP1_QUP5_SPI_APPS_CBCR_ADDR A:0x6180601c
y.create.l HWIO_GCC_BLSP1_QUP5_I2C_APPS_CBCR_ADDR A:0x61806020
y.create.l HWIO_GCC_BLSP1_QUP5_SPI_APPS_CMD_RCGR_ADDR A:0x61806024
y.create.l HWIO_GCC_BLSP1_QUP5_SPI_APPS_CFG_RCGR_ADDR A:0x61806028
y.create.l HWIO_GCC_BLSP1_QUP5_SPI_APPS_M_ADDR A:0x6180602c
y.create.l HWIO_GCC_BLSP1_QUP5_SPI_APPS_N_ADDR A:0x61806030
y.create.l HWIO_GCC_BLSP1_QUP5_SPI_APPS_D_ADDR A:0x61806034
y.create.l HWIO_GCC_BLSP1_UART5_BCR_ADDR A:0x61806038
y.create.l HWIO_GCC_BLSP1_UART5_APPS_CBCR_ADDR A:0x6180603c
y.create.l HWIO_GCC_BLSP1_UART5_SIM_CBCR_ADDR A:0x61806040
y.create.l HWIO_GCC_BLSP1_UART5_APPS_CMD_RCGR_ADDR A:0x61806044
y.create.l HWIO_GCC_BLSP1_UART5_APPS_CFG_RCGR_ADDR A:0x61806048
y.create.l HWIO_GCC_BLSP1_UART5_APPS_M_ADDR A:0x6180604c
y.create.l HWIO_GCC_BLSP1_UART5_APPS_N_ADDR A:0x61806050
y.create.l HWIO_GCC_BLSP1_UART5_APPS_D_ADDR A:0x61806054
y.create.l HWIO_GCC_BLSP1_QUP6_BCR_ADDR A:0x61807018
y.create.l HWIO_GCC_BLSP1_QUP6_SPI_APPS_CBCR_ADDR A:0x6180701c
y.create.l HWIO_GCC_BLSP1_QUP6_I2C_APPS_CBCR_ADDR A:0x61807020
y.create.l HWIO_GCC_BLSP1_QUP6_SPI_APPS_CMD_RCGR_ADDR A:0x61807024
y.create.l HWIO_GCC_BLSP1_QUP6_SPI_APPS_CFG_RCGR_ADDR A:0x61807028
y.create.l HWIO_GCC_BLSP1_QUP6_SPI_APPS_M_ADDR A:0x6180702c
y.create.l HWIO_GCC_BLSP1_QUP6_SPI_APPS_N_ADDR A:0x61807030
y.create.l HWIO_GCC_BLSP1_QUP6_SPI_APPS_D_ADDR A:0x61807034
y.create.l HWIO_GCC_BLSP1_UART6_BCR_ADDR A:0x61807038
y.create.l HWIO_GCC_BLSP1_UART6_APPS_CBCR_ADDR A:0x6180703c
y.create.l HWIO_GCC_BLSP1_UART6_SIM_CBCR_ADDR A:0x61807040
y.create.l HWIO_GCC_BLSP1_UART6_APPS_CMD_RCGR_ADDR A:0x61807044
y.create.l HWIO_GCC_BLSP1_UART6_APPS_CFG_RCGR_ADDR A:0x61807048
y.create.l HWIO_GCC_BLSP1_UART6_APPS_M_ADDR A:0x6180704c
y.create.l HWIO_GCC_BLSP1_UART6_APPS_N_ADDR A:0x61807050
y.create.l HWIO_GCC_BLSP1_UART6_APPS_D_ADDR A:0x61807054
y.create.l HWIO_GCC_BLSP_UART_SIM_CMD_RCGR_ADDR A:0x6180100c
y.create.l HWIO_GCC_BLSP_UART_SIM_CFG_RCGR_ADDR A:0x61801010
y.create.l HWIO_GCC_PRNG_XPU_CFG_AHB_CBCR_ADDR A:0x61817008
y.create.l HWIO_GCC_PDM_BCR_ADDR A:0x61844000
y.create.l HWIO_GCC_PDM_AHB_CBCR_ADDR A:0x61844004
y.create.l HWIO_GCC_PDM_XO4_CBCR_ADDR A:0x61844008
y.create.l HWIO_GCC_PDM2_CBCR_ADDR A:0x6184400c
y.create.l HWIO_GCC_PDM2_CMD_RCGR_ADDR A:0x61844010
y.create.l HWIO_GCC_PDM2_CFG_RCGR_ADDR A:0x61844014
y.create.l HWIO_GCC_PRNG_BCR_ADDR A:0x61813000
y.create.l HWIO_GCC_PRNG_AHB_CBCR_ADDR A:0x61813004
y.create.l HWIO_GCC_TCSR_BCR_ADDR A:0x61828000
y.create.l HWIO_GCC_TCSR_AHB_CBCR_ADDR A:0x61828004
y.create.l HWIO_GCC_BOOT_ROM_BCR_ADDR A:0x61813008
y.create.l HWIO_GCC_BOOT_ROM_AHB_CBCR_ADDR A:0x6181300c
y.create.l HWIO_GCC_MSG_RAM_BCR_ADDR A:0x6182b000
y.create.l HWIO_GCC_MSG_RAM_AHB_CBCR_ADDR A:0x6182b004
y.create.l HWIO_GCC_TLMM_BCR_ADDR A:0x61834000
y.create.l HWIO_GCC_TLMM_AHB_CBCR_ADDR A:0x61834004
y.create.l HWIO_GCC_TLMM_CBCR_ADDR A:0x61834008
y.create.l HWIO_GCC_MPM_BCR_ADDR A:0x6182c000
y.create.l HWIO_GCC_MPM_MISC_ADDR A:0x6182c004
y.create.l HWIO_GCC_MPM_AHB_CBCR_ADDR A:0x6182c008
y.create.l HWIO_GCC_RPM_PROC_HCLK_CBCR_ADDR A:0x6182d000
y.create.l HWIO_GCC_RPM_BUS_AHB_CBCR_ADDR A:0x6182d004
y.create.l HWIO_GCC_RPM_SLEEP_CBCR_ADDR A:0x6182d008
y.create.l HWIO_GCC_RPM_TIMER_CBCR_ADDR A:0x6182d00c
y.create.l HWIO_GCC_RPM_CMD_RCGR_ADDR A:0x6182d010
y.create.l HWIO_GCC_RPM_CFG_RCGR_ADDR A:0x6182d014
y.create.l HWIO_GCC_RPM_MISC_ADDR A:0x6182d028
y.create.l HWIO_GCC_SEC_CTRL_BCR_ADDR A:0x6181a000
y.create.l HWIO_GCC_ACC_CMD_RCGR_ADDR A:0x6181a004
y.create.l HWIO_GCC_ACC_CFG_RCGR_ADDR A:0x6181a008
y.create.l HWIO_GCC_ACC_MISC_ADDR A:0x6181a01c
y.create.l HWIO_GCC_SEC_CTRL_ACC_CBCR_ADDR A:0x6181a020
y.create.l HWIO_GCC_SEC_CTRL_AHB_CBCR_ADDR A:0x6181a024
y.create.l HWIO_GCC_SEC_CTRL_CBCR_ADDR A:0x6181a028
y.create.l HWIO_GCC_SEC_CTRL_SENSE_CBCR_ADDR A:0x6181a02c
y.create.l HWIO_GCC_SEC_CTRL_BOOT_ROM_PATCH_CBCR_ADDR A:0x6181a030
y.create.l HWIO_GCC_SEC_CTRL_CMD_RCGR_ADDR A:0x6181a034
y.create.l HWIO_GCC_SEC_CTRL_CFG_RCGR_ADDR A:0x6181a038
y.create.l HWIO_GCC_SPMI_BCR_ADDR A:0x6182e000
y.create.l HWIO_GCC_SPMI_SER_CMD_RCGR_ADDR A:0x6182e004
y.create.l HWIO_GCC_SPMI_SER_CFG_RCGR_ADDR A:0x6182e008
y.create.l HWIO_GCC_SPMI_SER_CBCR_ADDR A:0x6182e01c
y.create.l HWIO_GCC_SPMI_PCNOC_AHB_CBCR_ADDR A:0x6182e020
y.create.l HWIO_GCC_SPMI_AHB_CMD_RCGR_ADDR A:0x6182e024
y.create.l HWIO_GCC_SPMI_AHB_CFG_RCGR_ADDR A:0x6182e028
y.create.l HWIO_GCC_SPMI_AHB_CBCR_ADDR A:0x6182e03c
y.create.l HWIO_GCC_SPDM_BCR_ADDR A:0x6182f000
y.create.l HWIO_GCC_SPDM_CFG_AHB_CBCR_ADDR A:0x6182f004
y.create.l HWIO_GCC_SPDM_MSTR_AHB_CBCR_ADDR A:0x6182f008
y.create.l HWIO_GCC_SPDM_FF_CBCR_ADDR A:0x6182f00c
y.create.l HWIO_GCC_SPDM_BIMC_CY_CBCR_ADDR A:0x6182f010
y.create.l HWIO_GCC_SPDM_DEBUG_CY_CBCR_ADDR A:0x6182f018
y.create.l HWIO_GCC_SPDM_PCNOC_CY_CBCR_ADDR A:0x6182f01c
y.create.l HWIO_GCC_SPDM_RPM_CY_CBCR_ADDR A:0x6182f020
y.create.l HWIO_GCC_CRYPTO_BCR_ADDR A:0x61816000
y.create.l HWIO_GCC_CRYPTO_CMD_RCGR_ADDR A:0x61816004
y.create.l HWIO_GCC_CRYPTO_CFG_RCGR_ADDR A:0x61816008
y.create.l HWIO_GCC_CRYPTO_CBCR_ADDR A:0x6181601c
y.create.l HWIO_GCC_CRYPTO_AXI_CBCR_ADDR A:0x61816020
y.create.l HWIO_GCC_CRYPTO_AHB_CBCR_ADDR A:0x61816024
y.create.l HWIO_GCC_GCC_AHB_CBCR_ADDR A:0x61830014
y.create.l HWIO_GCC_GCC_XO_CMD_RCGR_ADDR A:0x61830018
y.create.l HWIO_GCC_GCC_XO_CBCR_ADDR A:0x61830030
y.create.l HWIO_GCC_GCC_XO_DIV4_CBCR_ADDR A:0x61830034
y.create.l HWIO_GCC_GCC_IM_SLEEP_CBCR_ADDR A:0x61830038
y.create.l HWIO_GCC_BIMC_BCR_ADDR A:0x61831000
y.create.l HWIO_GCC_BIMC_GDSCR_ADDR A:0x61831004
y.create.l HWIO_GCC_BIMC_DDR_XO_CMD_RCGR_ADDR A:0x61832000
y.create.l HWIO_GCC_BIMC_XO_CBCR_ADDR A:0x61831008
y.create.l HWIO_GCC_BIMC_CFG_AHB_CBCR_ADDR A:0x6183100c
y.create.l HWIO_GCC_BIMC_SLEEP_CBCR_ADDR A:0x61831010
y.create.l HWIO_GCC_BIMC_PCNOC_AXI_CBCR_ADDR A:0x61831024
y.create.l HWIO_GCC_BIMC_DDR_CMD_RCGR_ADDR A:0x61832004
y.create.l HWIO_GCC_BIMC_DDR_CFG_RCGR_ADDR A:0x61832008
y.create.l HWIO_GCC_BIMC_MISC_ADDR A:0x61831018
y.create.l HWIO_GCC_BIMC_CBCR_ADDR A:0x6183101c
y.create.l HWIO_GCC_BIMC_APSS_AXI_CBCR_ADDR A:0x61831020
y.create.l HWIO_GCC_DDR_DIM_CFG_CBCR_ADDR A:0x6183201c
y.create.l HWIO_GCC_DDR_DIM_SLEEP_CBCR_ADDR A:0x61832020
y.create.l HWIO_GCC_APSS_TCU_CMD_RCGR_ADDR A:0x61837000
y.create.l HWIO_GCC_APSS_TCU_CFG_RCGR_ADDR A:0x61837004
y.create.l HWIO_GCC_BIMC_MSS_CMD_RCGR_ADDR A:0x61831050
y.create.l HWIO_GCC_BIMC_MSS_CFG_RCGR_ADDR A:0x61831054
y.create.l HWIO_GCC_BIMC_TCU_CBCR_ADDR A:0x61831044
y.create.l HWIO_GCC_ULTAUDIO_PCNOC_MPORT_CBCR_ADDR A:0x6181c000
y.create.l HWIO_GCC_ULTAUDIO_PCNOC_SWAY_CBCR_ADDR A:0x6181c004
y.create.l HWIO_GCC_ULT_AUDIO_BCR_ADDR A:0x6181c0b4
y.create.l HWIO_GCC_APSS_AHB_CMD_RCGR_ADDR A:0x61846000
y.create.l HWIO_GCC_APSS_AHB_CFG_RCGR_ADDR A:0x61846004
y.create.l HWIO_GCC_APSS_AHB_MISC_ADDR A:0x61846018
y.create.l HWIO_GCC_APSS_AHB_CBCR_ADDR A:0x6184601c
y.create.l HWIO_GCC_APSS_AXI_CBCR_ADDR A:0x61846020
y.create.l HWIO_GCC_SNOC_BUS_TIMEOUT0_BCR_ADDR A:0x61847000
y.create.l HWIO_GCC_SNOC_BUS_TIMEOUT0_AHB_CBCR_ADDR A:0x61847004
y.create.l HWIO_GCC_PCNOC_BUS_TIMEOUT0_BCR_ADDR A:0x61848000
y.create.l HWIO_GCC_PCNOC_BUS_TIMEOUT0_AHB_CBCR_ADDR A:0x61848004
y.create.l HWIO_GCC_PCNOC_BUS_TIMEOUT1_BCR_ADDR A:0x61848008
y.create.l HWIO_GCC_PCNOC_BUS_TIMEOUT1_AHB_CBCR_ADDR A:0x6184800c
y.create.l HWIO_GCC_PCNOC_BUS_TIMEOUT2_BCR_ADDR A:0x61848010
y.create.l HWIO_GCC_PCNOC_BUS_TIMEOUT2_AHB_CBCR_ADDR A:0x61848014
y.create.l HWIO_GCC_PCNOC_BUS_TIMEOUT3_BCR_ADDR A:0x61848018
y.create.l HWIO_GCC_PCNOC_BUS_TIMEOUT3_AHB_CBCR_ADDR A:0x6184801c
y.create.l HWIO_GCC_PCNOC_BUS_TIMEOUT4_BCR_ADDR A:0x61848020
y.create.l HWIO_GCC_PCNOC_BUS_TIMEOUT4_AHB_CBCR_ADDR A:0x61848024
y.create.l HWIO_GCC_PCNOC_BUS_TIMEOUT5_BCR_ADDR A:0x61848028
y.create.l HWIO_GCC_PCNOC_BUS_TIMEOUT5_AHB_CBCR_ADDR A:0x6184802c
y.create.l HWIO_GCC_PCNOC_BUS_TIMEOUT6_BCR_ADDR A:0x61848030
y.create.l HWIO_GCC_PCNOC_BUS_TIMEOUT6_AHB_CBCR_ADDR A:0x61848034
y.create.l HWIO_GCC_PCNOC_BUS_TIMEOUT7_BCR_ADDR A:0x61848038
y.create.l HWIO_GCC_PCNOC_BUS_TIMEOUT7_AHB_CBCR_ADDR A:0x6184803c
y.create.l HWIO_GCC_PCNOC_BUS_TIMEOUT8_BCR_ADDR A:0x61848040
y.create.l HWIO_GCC_PCNOC_BUS_TIMEOUT8_AHB_CBCR_ADDR A:0x61848044
y.create.l HWIO_GCC_PCNOC_BUS_TIMEOUT9_BCR_ADDR A:0x61848048
y.create.l HWIO_GCC_PCNOC_BUS_TIMEOUT9_AHB_CBCR_ADDR A:0x6184804c
y.create.l HWIO_GCC_DEHR_BCR_ADDR A:0x6181f000
y.create.l HWIO_GCC_DEHR_CBCR_ADDR A:0x6181f004
y.create.l HWIO_GCC_PCNOC_MPU_CFG_AHB_CBCR_ADDR A:0x6181700c
y.create.l HWIO_GCC_APSS_TCU_ASYNC_CBCR_ADDR A:0x61812098
y.create.l HWIO_GCC_APSS_TCU_CBCR_ADDR A:0x61812018
y.create.l HWIO_GCC_MSS_TBU_AXI_CBCR_ADDR A:0x61812024
y.create.l HWIO_GCC_MSS_TBU_GSS_AXI_CBCR_ADDR A:0x61812028
y.create.l HWIO_GCC_MSS_TBU_Q6_AXI_CBCR_ADDR A:0x6181202c
y.create.l HWIO_GCC_PCNOC_TBU_CBCR_ADDR A:0x61812030
y.create.l HWIO_GCC_SMMU_CFG_CBCR_ADDR A:0x61812038
y.create.l HWIO_GCC_SMMU_XPU_CBCR_ADDR A:0x61817010
y.create.l HWIO_GCC_BIMC_NOC_MPU_AHB_CBCR_ADDR A:0x61812100
y.create.l HWIO_GCC_SMMU_CATS_CBCR_ADDR A:0x6187c004
y.create.l HWIO_GCC_SMMU_CATS_BCR_ADDR A:0x6187c000
y.create.l HWIO_GCC_SMMU_BCR_ADDR A:0x61812000
y.create.l HWIO_GCC_APSS_TCU_BCR_ADDR A:0x61812050
y.create.l HWIO_GCC_MSS_TBU_AXI_BCR_ADDR A:0x61865000
y.create.l HWIO_GCC_MSS_TBU_Q6_AXI_BCR_ADDR A:0x61867000
y.create.l HWIO_GCC_MSS_TBU_GSS_AXI_BCR_ADDR A:0x61866000
y.create.l HWIO_GCC_SMMU_XPU_BCR_ADDR A:0x61812054
y.create.l HWIO_GCC_SMMU_CFG_BCR_ADDR A:0x6181208c
y.create.l HWIO_GCC_PCNOC_TBU_BCR_ADDR A:0x61812058
y.create.l HWIO_GCC_RBCPR_BCR_ADDR A:0x61833000
y.create.l HWIO_GCC_RBCPR_CBCR_ADDR A:0x61833004
y.create.l HWIO_GCC_RBCPR_AHB_CBCR_ADDR A:0x61833008
y.create.l HWIO_GCC_RBCPR_CMD_RCGR_ADDR A:0x6183300c
y.create.l HWIO_GCC_RBCPR_CFG_RCGR_ADDR A:0x61833010
y.create.l HWIO_GCC_RPM_GPLL_ENA_VOTE_ADDR A:0x61836000
y.create.l HWIO_GCC_RPM_CLOCK_BRANCH_ENA_VOTE_ADDR A:0x61836004
y.create.l HWIO_GCC_RPM_SMMU_CLOCK_BRANCH_ENA_VOTE_ADDR A:0x6183600c
y.create.l HWIO_GCC_RPM_CLOCK_SLEEP_ENA_VOTE_ADDR A:0x61836008
y.create.l HWIO_GCC_RPM_SMMU_CLOCK_SLEEP_ENA_VOTE_ADDR A:0x61836010
y.create.l HWIO_GCC_APCS_GPLL_ENA_VOTE_ADDR A:0x61845000
y.create.l HWIO_GCC_APCS_CLOCK_BRANCH_ENA_VOTE_ADDR A:0x61845004
y.create.l HWIO_GCC_APCS_SMMU_CLOCK_BRANCH_ENA_VOTE_ADDR A:0x6184500c
y.create.l HWIO_GCC_APCS_CLOCK_SLEEP_ENA_VOTE_ADDR A:0x61845008
y.create.l HWIO_GCC_APCS_SMMU_CLOCK_SLEEP_ENA_VOTE_ADDR A:0x61845010
y.create.l HWIO_GCC_APCS_TZ_GPLL_ENA_VOTE_ADDR A:0x61813010
y.create.l HWIO_GCC_APCS_TZ_CLOCK_BRANCH_ENA_VOTE_ADDR A:0x61813014
y.create.l HWIO_GCC_APCS_TZ_SMMU_CLOCK_BRANCH_ENA_VOTE_ADDR A:0x61813020
y.create.l HWIO_GCC_APCS_TZ_CLOCK_SLEEP_ENA_VOTE_ADDR A:0x61813018
y.create.l HWIO_GCC_APCS_TZ_SMMU_CLOCK_SLEEP_ENA_VOTE_ADDR A:0x61813024
y.create.l HWIO_GCC_APCS_HYP_GPLL_ENA_VOTE_ADDR A:0x61861000
y.create.l HWIO_GCC_APCS_HYP_CLOCK_BRANCH_ENA_VOTE_ADDR A:0x61861004
y.create.l HWIO_GCC_APCS_HYP_SMMU_CLOCK_BRANCH_ENA_VOTE_ADDR A:0x6186100c
y.create.l HWIO_GCC_APCS_HYP_CLOCK_SLEEP_ENA_VOTE_ADDR A:0x61861008
y.create.l HWIO_GCC_APCS_HYP_SMMU_CLOCK_SLEEP_ENA_VOTE_ADDR A:0x61861010
y.create.l HWIO_GCC_MSS_Q6_GPLL_ENA_VOTE_ADDR A:0x6181b000
y.create.l HWIO_GCC_MSS_Q6_CLOCK_BRANCH_ENA_VOTE_ADDR A:0x6181b004
y.create.l HWIO_GCC_MSS_Q6_CLOCK_SLEEP_ENA_VOTE_ADDR A:0x6181b008
y.create.l HWIO_GCC_SPARE_GPLL_ENA_VOTE_ADDR A:0x61800000
y.create.l HWIO_GCC_SPARE_CLOCK_BRANCH_ENA_VOTE_ADDR A:0x61800004
y.create.l HWIO_GCC_MSS_RESTART_ADDR A:0x6183e000
y.create.l HWIO_GCC_RESET_DEBUG_ADDR A:0x61814000
y.create.l HWIO_GCC_FLUSH_ETR_DEBUG_TIMER_ADDR A:0x61815000
y.create.l HWIO_GCC_STOP_CAPTURE_DEBUG_TIMER_ADDR A:0x61815004
y.create.l HWIO_GCC_RESET_STATUS_ADDR A:0x61815008
y.create.l HWIO_GCC_SW_SRST_ADDR A:0x6181500c
y.create.l HWIO_GCC_PROC_HALT_ADDR A:0x6181301c
y.create.l HWIO_GCC_GCC_DEBUG_CLK_CTL_ADDR A:0x61874000
y.create.l HWIO_GCC_CLOCK_FRQ_MEASURE_CTL_ADDR A:0x61874004
y.create.l HWIO_GCC_CLOCK_FRQ_MEASURE_STATUS_ADDR A:0x61874008
y.create.l HWIO_GCC_PLLTEST_PAD_CFG_ADDR A:0x6187400c
y.create.l HWIO_GCC_EMAC_0_AHB_CBCR_ADDR A:0x6184e000
y.create.l HWIO_GCC_EMAC_0_BCR_ADDR A:0x6184e004
y.create.l HWIO_GCC_EMAC_0_AXI_CBCR_ADDR A:0x6184e008
y.create.l HWIO_GCC_EMAC_0_TX_CBCR_ADDR A:0x6184e00c
y.create.l HWIO_GCC_EMAC_0_125M_CBCR_ADDR A:0x6184e010
y.create.l HWIO_GCC_EMAC_0_TX_CMD_RCGR_ADDR A:0x6184e014
y.create.l HWIO_GCC_EMAC_0_TX_CFG_RCGR_ADDR A:0x6184e018
y.create.l HWIO_GCC_EMAC_0_TX_M_ADDR A:0x6184e01c
y.create.l HWIO_GCC_EMAC_0_TX_N_ADDR A:0x6184e020
y.create.l HWIO_GCC_EMAC_0_TX_D_ADDR A:0x6184e024
y.create.l HWIO_GCC_EMAC_0_125M_CMD_RCGR_ADDR A:0x6184e028
y.create.l HWIO_GCC_EMAC_0_125M_CFG_RCGR_ADDR A:0x6184e02c
y.create.l HWIO_GCC_EMAC_0_RX_CBCR_ADDR A:0x6184e030
y.create.l HWIO_GCC_EMAC_0_SYS_CBCR_ADDR A:0x6184e034
y.create.l HWIO_GCC_EMAC_0_SYS_25M_CBCR_ADDR A:0x6184e038
y.create.l HWIO_GCC_EMAC_0_SYS_25M_CMD_RCGR_ADDR A:0x6184e03c
y.create.l HWIO_GCC_EMAC_0_SYS_25M_CFG_RCGR_ADDR A:0x6184e040
y.create.l HWIO_GCC_JITTER_PROBE_CFG_ADDR A:0x61874010
y.create.l HWIO_GCC_JITTER_PROBE_VAL_ADDR A:0x61874014
y.create.l HWIO_GCC_GP1_CBCR_ADDR A:0x61808000
y.create.l HWIO_GCC_GP1_CMD_RCGR_ADDR A:0x61808004
y.create.l HWIO_GCC_GP1_CFG_RCGR_ADDR A:0x61808008
y.create.l HWIO_GCC_GP1_M_ADDR A:0x6180800c
y.create.l HWIO_GCC_GP1_N_ADDR A:0x61808010
y.create.l HWIO_GCC_GP1_D_ADDR A:0x61808014
y.create.l HWIO_GCC_GP2_CBCR_ADDR A:0x61809000
y.create.l HWIO_GCC_GP2_CMD_RCGR_ADDR A:0x61809004
y.create.l HWIO_GCC_GP2_CFG_RCGR_ADDR A:0x61809008
y.create.l HWIO_GCC_GP2_M_ADDR A:0x6180900c
y.create.l HWIO_GCC_GP2_N_ADDR A:0x61809010
y.create.l HWIO_GCC_GP2_D_ADDR A:0x61809014
y.create.l HWIO_GCC_GP3_CBCR_ADDR A:0x6180a000
y.create.l HWIO_GCC_GP3_CMD_RCGR_ADDR A:0x6180a004
y.create.l HWIO_GCC_GP3_CFG_RCGR_ADDR A:0x6180a008
y.create.l HWIO_GCC_GP3_M_ADDR A:0x6180a00c
y.create.l HWIO_GCC_GP3_N_ADDR A:0x6180a010
y.create.l HWIO_GCC_GP3_D_ADDR A:0x6180a014
y.create.l HWIO_GCC_APSS_MISC_ADDR A:0x61860000
y.create.l HWIO_GCC_TIC_MODE_APSS_BOOT_ADDR A:0x6187f000
y.create.l HWIO_GCC_USB_BOOT_CLOCK_CTL_ADDR A:0x61840000
y.create.l HWIO_GCC_RAW_SLEEP_CLK_CTRL_ADDR A:0x61835000
y.create.l HWIO_GCC_S1LM_MODEM_DIV_VOTE_ADDR A:0x61800008
y.create.l HWIO_GCC_GCC_SPARE1_REG_ADDR A:0x6180000c
y.create.l HWIO_GCC_S1LM_APPS_DIV_VOTE_ADDR A:0x6187e000
y.create.l HWIO_GCC_GCC_SPARE3_REG_ADDR A:0x6187e004
y.create.l HWIO_GCC_DCD_BCR_ADDR A:0x6182a000
y.create.l HWIO_GCC_DCD_XO_CBCR_ADDR A:0x6182a004
y.create.l HWIO_GCC_SNOC_DCD_CONFIG_ADDR A:0x6182a008
y.create.l HWIO_GCC_SNOC_DCD_HYSTERESIS_CNT_ADDR A:0x6182a00c
y.create.l HWIO_GCC_PCNOC_DCD_CONFIG_ADDR A:0x6182a010
y.create.l HWIO_GCC_PCNOC_DCD_HYSTERESIS_CNT_ADDR A:0x6182a014
y.create.l HWIO_GCC_AUDIO_CORE_BCR_ADDR A:0x6181c008
y.create.l HWIO_GCC_ULTAUDIO_LPAIF_PRI_I2S_CMD_RCGR_ADDR A:0x6181c054
y.create.l HWIO_GCC_ULTAUDIO_LPAIF_PRI_I2S_CFG_RCGR_ADDR A:0x6181c058
y.create.l HWIO_GCC_ULTAUDIO_LPAIF_PRI_I2S_M_ADDR A:0x6181c05c
y.create.l HWIO_GCC_ULTAUDIO_LPAIF_PRI_I2S_N_ADDR A:0x6181c060
y.create.l HWIO_GCC_ULTAUDIO_LPAIF_PRI_I2S_D_ADDR A:0x6181c064
y.create.l HWIO_GCC_ULTAUDIO_LPAIF_PRI_I2S_CBCR_ADDR A:0x6181c068
y.create.l HWIO_GCC_ULTAUDIO_LPAIF_SEC_I2S_CMD_RCGR_ADDR A:0x6181c06c
y.create.l HWIO_GCC_ULTAUDIO_LPAIF_SEC_I2S_CFG_RCGR_ADDR A:0x6181c070
y.create.l HWIO_GCC_ULTAUDIO_LPAIF_SEC_I2S_M_ADDR A:0x6181c074
y.create.l HWIO_GCC_ULTAUDIO_LPAIF_SEC_I2S_N_ADDR A:0x6181c078
y.create.l HWIO_GCC_ULTAUDIO_LPAIF_SEC_I2S_D_ADDR A:0x6181c07c
y.create.l HWIO_GCC_ULTAUDIO_LPAIF_SEC_I2S_CBCR_ADDR A:0x6181c080
y.create.l HWIO_GCC_ULTAUDIO_XO_CMD_RCGR_ADDR A:0x6181c034
y.create.l HWIO_GCC_ULTAUDIO_XO_CFG_RCGR_ADDR A:0x6181c038
y.create.l HWIO_GCC_ULTAUDIO_AHBFABRIC_CMD_RCGR_ADDR A:0x6181c010
y.create.l HWIO_GCC_ULTAUDIO_AHBFABRIC_CFG_RCGR_ADDR A:0x6181c014
y.create.l HWIO_GCC_ULTAUDIO_AHBFABRIC_M_ADDR A:0x6181c018
y.create.l HWIO_GCC_ULTAUDIO_AHBFABRIC_N_ADDR A:0x6181c01c
y.create.l HWIO_GCC_ULTAUDIO_AHBFABRIC_D_ADDR A:0x6181c020
y.create.l HWIO_GCC_ULTAUDIO_AHBFABRIC_IXFABRIC_LPM_CBCR_ADDR A:0x6181c024
y.create.l HWIO_GCC_ULTAUDIO_AHBFABRIC_IXFABRIC_CBCR_ADDR A:0x6181c028
y.create.l HWIO_GCC_ULTAUDIO_AVSYNC_XO_CBCR_ADDR A:0x6181c04c
y.create.l HWIO_GCC_ULTAUDIO_STC_XO_CBCR_ADDR A:0x6181c050
y.create.l HWIO_GCC_ULTAUDIO_AHBFABRIC_EFABRIC_SPDM_CBCR_ADDR A:0x6181c030
y.create.l HWIO_GCC_ULTAUDIO_LPAIF_AUX_I2S_CMD_RCGR_ADDR A:0x6181c084
y.create.l HWIO_GCC_ULTAUDIO_LPAIF_AUX_I2S_CFG_RCGR_ADDR A:0x6181c088
y.create.l HWIO_GCC_ULTAUDIO_LPAIF_AUX_I2S_M_ADDR A:0x6181c08c
y.create.l HWIO_GCC_ULTAUDIO_LPAIF_AUX_I2S_N_ADDR A:0x6181c090
y.create.l HWIO_GCC_ULTAUDIO_LPAIF_AUX_I2S_D_ADDR A:0x6181c094
y.create.l HWIO_GCC_ULTAUDIO_LPAIF_AUX_I2S_CBCR_ADDR A:0x6181c098
y.create.l HWIO_GCC_ULTAUDIO_PCM_DATA_OE_CMD_RCGR_ADDR A:0x6181c0f0
y.create.l HWIO_GCC_ULTAUDIO_PCM_DATA_OE_CFG_RCGR_ADDR A:0x6181c0f4
y.create.l HWIO_GCC_ULTAUDIO_PCM_DATA_OE_M_ADDR A:0x6181c0f8
y.create.l HWIO_GCC_ULTAUDIO_PCM_DATA_OE_N_ADDR A:0x6181c0fc
y.create.l HWIO_GCC_ULTAUDIO_PCM_DATA_OE_D_ADDR A:0x6181c100
y.create.l HWIO_GCC_ULTAUDIO_PCM_DATA_OE_CBCR_ADDR A:0x6181c104
y.create.l HWIO_GCC_ULTAUDIO_SEC_PCM_DATA_OE_CMD_RCGR_ADDR A:0x6181c108
y.create.l HWIO_GCC_ULTAUDIO_SEC_PCM_DATA_OE_CFG_RCGR_ADDR A:0x6181c10c
y.create.l HWIO_GCC_ULTAUDIO_SEC_PCM_DATA_OE_M_ADDR A:0x6181c110
y.create.l HWIO_GCC_ULTAUDIO_SEC_PCM_DATA_OE_N_ADDR A:0x6181c114
y.create.l HWIO_GCC_ULTAUDIO_SEC_PCM_DATA_OE_D_ADDR A:0x6181c118
y.create.l HWIO_GCC_ULTAUDIO_SEC_PCM_DATA_OE_CBCR_ADDR A:0x6181c11c
y.create.l HWIO_GCC_ULTAUDIO_TER_PCM_DATA_OE_CMD_RCGR_ADDR A:0x6181c120
y.create.l HWIO_GCC_ULTAUDIO_TER_PCM_DATA_OE_CFG_RCGR_ADDR A:0x6181c124
y.create.l HWIO_GCC_ULTAUDIO_TER_PCM_DATA_OE_M_ADDR A:0x6181c128
y.create.l HWIO_GCC_ULTAUDIO_TER_PCM_DATA_OE_N_ADDR A:0x6181c12c
y.create.l HWIO_GCC_ULTAUDIO_TER_PCM_DATA_OE_D_ADDR A:0x6181c130
y.create.l HWIO_GCC_ULTAUDIO_TER_PCM_DATA_OE_CBCR_ADDR A:0x6181c134
y.create.l HWIO_GCC_ULTAUDIO_EXT_MCLK2_CMD_RCGR_ADDR A:0x6181c0d8
y.create.l HWIO_GCC_ULTAUDIO_EXT_MCLK2_CFG_RCGR_ADDR A:0x6181c0dc
y.create.l HWIO_GCC_ULTAUDIO_EXT_MCLK2_M_ADDR A:0x6181c0e0
y.create.l HWIO_GCC_ULTAUDIO_EXT_MCLK2_N_ADDR A:0x6181c0e4
y.create.l HWIO_GCC_ULTAUDIO_EXT_MCLK2_D_ADDR A:0x6181c0e8
y.create.l HWIO_GCC_ULTAUDIO_EXT_MCLK2_CBCR_ADDR A:0x6181c0ec
y.create.l HWIO_GCC_AUDIO_REF_CLOCK_SEL_ADDR A:0x6181c0b8
y.create.l HWIO_GCC_RPU_XPU_SCR_ADDR A:0x61880000
y.create.l HWIO_GCC_RPU_XPU_SWDR_ADDR A:0x61880004
y.create.l HWIO_GCC_RPU_XPU_SEAR0_ADDR A:0x61880040
y.create.l HWIO_GCC_RPU_XPU_SESR_ADDR A:0x61880048
y.create.l HWIO_GCC_RPU_XPU_SESRRESTORE_ADDR A:0x6188004c
y.create.l HWIO_GCC_RPU_XPU_SESYNR0_ADDR A:0x61880050
y.create.l HWIO_GCC_RPU_XPU_SESYNR1_ADDR A:0x61880054
y.create.l HWIO_GCC_RPU_XPU_SESYNR2_ADDR A:0x61880058
y.create.l HWIO_GCC_RPU_XPU_MCR_ADDR A:0x61880100
y.create.l HWIO_GCC_RPU_XPU_MEAR0_ADDR A:0x61880140
y.create.l HWIO_GCC_RPU_XPU_MESR_ADDR A:0x61880148
y.create.l HWIO_GCC_RPU_XPU_MESRRESTORE_ADDR A:0x6188014c
y.create.l HWIO_GCC_RPU_XPU_MESYNR0_ADDR A:0x61880150
y.create.l HWIO_GCC_RPU_XPU_MESYNR1_ADDR A:0x61880154
y.create.l HWIO_GCC_RPU_XPU_MESYNR2_ADDR A:0x61880158
y.create.l HWIO_GCC_RPU_XPU_CR_ADDR A:0x61880080
y.create.l HWIO_GCC_RPU_XPU_RPU_ACR0_ADDR A:0x618800a0
y.create.l HWIO_GCC_RPU_XPU_EAR0_ADDR A:0x618800c0
y.create.l HWIO_GCC_RPU_XPU_ESR_ADDR A:0x618800c8
y.create.l HWIO_GCC_RPU_XPU_ESRRESTORE_ADDR A:0x618800cc
y.create.l HWIO_GCC_RPU_XPU_ESYNR0_ADDR A:0x618800d0
y.create.l HWIO_GCC_RPU_XPU_ESYNR1_ADDR A:0x618800d4
y.create.l HWIO_GCC_RPU_XPU_ESYNR2_ADDR A:0x618800d8
y.create.l HWIO_GCC_RPU_XPU_IDR0_ADDR A:0x61880074
y.create.l HWIO_GCC_RPU_XPU_IDR1_ADDR A:0x61880078
y.create.l HWIO_GCC_RPU_XPU_REV_ADDR A:0x6188007c
y.create.l HWIO_GCC_RPU_XPU_RG0_RACR0_ADDR A:0x61880200
y.create.l HWIO_GCC_RPU_XPU_RG1_RACR0_ADDR A:0x61880280
y.create.l HWIO_GCC_RPU_XPU_RG2_RACR0_ADDR A:0x61880300
y.create.l HWIO_GCC_RPU_XPU_RG3_RACR0_ADDR A:0x61880380
y.create.l HWIO_GCC_RPU_XPU_RG4_RACR0_ADDR A:0x61880400
y.create.l HWIO_GCC_RPU_XPU_RG5_RACR0_ADDR A:0x61880480
y.create.l HWIO_GCC_RPU_XPU_RG6_RACR0_ADDR A:0x61880500
y.create.l HWIO_GCC_RPU_XPU_RG7_RACR0_ADDR A:0x61880580
y.create.l HWIO_GCC_RPU_XPU_RG8_RACR0_ADDR A:0x61880600
y.create.l HWIO_GCC_RPU_XPU_RG9_RACR0_ADDR A:0x61880680
y.create.l HWIO_GCC_RPU_XPU_RG0_WACR0_ADDR A:0x61880220
y.create.l HWIO_GCC_RPU_XPU_RG1_WACR0_ADDR A:0x618802a0
y.create.l HWIO_GCC_RPU_XPU_RG2_WACR0_ADDR A:0x61880320
y.create.l HWIO_GCC_RPU_XPU_RG3_WACR0_ADDR A:0x618803a0
y.create.l HWIO_GCC_RPU_XPU_RG4_WACR0_ADDR A:0x61880420
y.create.l HWIO_GCC_RPU_XPU_RG5_WACR0_ADDR A:0x618804a0
y.create.l HWIO_GCC_RPU_XPU_RG6_WACR0_ADDR A:0x61880520
y.create.l HWIO_GCC_RPU_XPU_RG7_WACR0_ADDR A:0x618805a0
y.create.l HWIO_GCC_RPU_XPU_RG8_WACR0_ADDR A:0x61880620
y.create.l HWIO_GCC_RPU_XPU_RG9_WACR0_ADDR A:0x618806a0
y.create.l HWIO_GCC_RPU_XPU_RG0_SCR_ADDR A:0x61880250
y.create.l HWIO_GCC_RPU_XPU_RG1_SCR_ADDR A:0x618802d0
y.create.l HWIO_GCC_RPU_XPU_RG2_SCR_ADDR A:0x61880350
y.create.l HWIO_GCC_RPU_XPU_RG3_SCR_ADDR A:0x618803d0
y.create.l HWIO_GCC_RPU_XPU_RG4_SCR_ADDR A:0x61880450
y.create.l HWIO_GCC_RPU_XPU_RG5_SCR_ADDR A:0x618804d0
y.create.l HWIO_GCC_RPU_XPU_RG6_SCR_ADDR A:0x61880550
y.create.l HWIO_GCC_RPU_XPU_RG7_SCR_ADDR A:0x618805d0
y.create.l HWIO_GCC_RPU_XPU_RG8_SCR_ADDR A:0x61880650
y.create.l HWIO_GCC_RPU_XPU_RG9_SCR_ADDR A:0x618806d0
y.create.l HWIO_GCC_RPU_XPU_RG0_MCR_ADDR A:0x61880254
y.create.l HWIO_GCC_RPU_XPU_RG1_MCR_ADDR A:0x618802d4
y.create.l HWIO_GCC_RPU_XPU_RG2_MCR_ADDR A:0x61880354
y.create.l HWIO_GCC_RPU_XPU_RG3_MCR_ADDR A:0x618803d4
y.create.l HWIO_GCC_RPU_XPU_RG4_MCR_ADDR A:0x61880454
y.create.l HWIO_GCC_RPU_XPU_RG5_MCR_ADDR A:0x618804d4
y.create.l HWIO_GCC_RPU_XPU_RG6_MCR_ADDR A:0x61880554
y.create.l HWIO_GCC_RPU_XPU_RG7_MCR_ADDR A:0x618805d4
y.create.l HWIO_GCC_RPU_XPU_RG8_MCR_ADDR A:0x61880654
y.create.l HWIO_GCC_RPU_XPU_RG9_MCR_ADDR A:0x618806d4
y.create.l HWIO_TCSR_MUTEX_REG_0_ADDR A:0x61905000
y.create.l HWIO_TCSR_MUTEX_REG_1_ADDR A:0x61906000
y.create.l HWIO_TCSR_MUTEX_REG_2_ADDR A:0x61907000
y.create.l HWIO_TCSR_MUTEX_REG_3_ADDR A:0x61908000
y.create.l HWIO_TCSR_MUTEX_REG_4_ADDR A:0x61909000
y.create.l HWIO_TCSR_MUTEX_REG_5_ADDR A:0x6190a000
y.create.l HWIO_TCSR_MUTEX_REG_6_ADDR A:0x6190b000
y.create.l HWIO_TCSR_MUTEX_REG_7_ADDR A:0x6190c000
y.create.l HWIO_TCSR_MUTEX_REG_8_ADDR A:0x6190d000
y.create.l HWIO_TCSR_MUTEX_REG_9_ADDR A:0x6190e000
y.create.l HWIO_TCSR_REGS_XPU_SCR_ADDR A:0x61936000
y.create.l HWIO_TCSR_REGS_XPU_SWDR_ADDR A:0x61936004
y.create.l HWIO_TCSR_REGS_XPU_SEAR0_ADDR A:0x61936040
y.create.l HWIO_TCSR_REGS_XPU_SESR_ADDR A:0x61936048
y.create.l HWIO_TCSR_REGS_XPU_SESRRESTORE_ADDR A:0x6193604c
y.create.l HWIO_TCSR_REGS_XPU_SESYNR0_ADDR A:0x61936050
y.create.l HWIO_TCSR_REGS_XPU_SESYNR1_ADDR A:0x61936054
y.create.l HWIO_TCSR_REGS_XPU_SESYNR2_ADDR A:0x61936058
y.create.l HWIO_TCSR_REGS_XPU_MCR_ADDR A:0x61936100
y.create.l HWIO_TCSR_REGS_XPU_MEAR0_ADDR A:0x61936140
y.create.l HWIO_TCSR_REGS_XPU_MESR_ADDR A:0x61936148
y.create.l HWIO_TCSR_REGS_XPU_MESRRESTORE_ADDR A:0x6193614c
y.create.l HWIO_TCSR_REGS_XPU_MESYNR0_ADDR A:0x61936150
y.create.l HWIO_TCSR_REGS_XPU_MESYNR1_ADDR A:0x61936154
y.create.l HWIO_TCSR_REGS_XPU_MESYNR2_ADDR A:0x61936158
y.create.l HWIO_TCSR_REGS_XPU_CR_ADDR A:0x61936080
y.create.l HWIO_TCSR_REGS_XPU_RPU_ACR0_ADDR A:0x619360a0
y.create.l HWIO_TCSR_REGS_XPU_EAR0_ADDR A:0x619360c0
y.create.l HWIO_TCSR_REGS_XPU_ESR_ADDR A:0x619360c8
y.create.l HWIO_TCSR_REGS_XPU_ESRRESTORE_ADDR A:0x619360cc
y.create.l HWIO_TCSR_REGS_XPU_ESYNR0_ADDR A:0x619360d0
y.create.l HWIO_TCSR_REGS_XPU_ESYNR1_ADDR A:0x619360d4
y.create.l HWIO_TCSR_REGS_XPU_ESYNR2_ADDR A:0x619360d8
y.create.l HWIO_TCSR_REGS_XPU_IDR0_ADDR A:0x61936074
y.create.l HWIO_TCSR_REGS_XPU_IDR1_ADDR A:0x61936078
y.create.l HWIO_TCSR_REGS_XPU_REV_ADDR A:0x6193607c
y.create.l HWIO_TCSR_REGS_XPU_RG0_RACR0_ADDR A:0x61936200
y.create.l HWIO_TCSR_REGS_XPU_RG1_RACR0_ADDR A:0x61936280
y.create.l HWIO_TCSR_REGS_XPU_RG2_RACR0_ADDR A:0x61936300
y.create.l HWIO_TCSR_REGS_XPU_RG3_RACR0_ADDR A:0x61936380
y.create.l HWIO_TCSR_REGS_XPU_RG4_RACR0_ADDR A:0x61936400
y.create.l HWIO_TCSR_REGS_XPU_RG5_RACR0_ADDR A:0x61936480
y.create.l HWIO_TCSR_REGS_XPU_RG6_RACR0_ADDR A:0x61936500
y.create.l HWIO_TCSR_REGS_XPU_RG7_RACR0_ADDR A:0x61936580
y.create.l HWIO_TCSR_REGS_XPU_RG8_RACR0_ADDR A:0x61936600
y.create.l HWIO_TCSR_REGS_XPU_RG9_RACR0_ADDR A:0x61936680
y.create.l HWIO_TCSR_REGS_XPU_RG0_WACR0_ADDR A:0x61936220
y.create.l HWIO_TCSR_REGS_XPU_RG1_WACR0_ADDR A:0x619362a0
y.create.l HWIO_TCSR_REGS_XPU_RG2_WACR0_ADDR A:0x61936320
y.create.l HWIO_TCSR_REGS_XPU_RG3_WACR0_ADDR A:0x619363a0
y.create.l HWIO_TCSR_REGS_XPU_RG4_WACR0_ADDR A:0x61936420
y.create.l HWIO_TCSR_REGS_XPU_RG5_WACR0_ADDR A:0x619364a0
y.create.l HWIO_TCSR_REGS_XPU_RG6_WACR0_ADDR A:0x61936520
y.create.l HWIO_TCSR_REGS_XPU_RG7_WACR0_ADDR A:0x619365a0
y.create.l HWIO_TCSR_REGS_XPU_RG8_WACR0_ADDR A:0x61936620
y.create.l HWIO_TCSR_REGS_XPU_RG9_WACR0_ADDR A:0x619366a0
y.create.l HWIO_TCSR_REGS_XPU_RG0_SCR_ADDR A:0x61936250
y.create.l HWIO_TCSR_REGS_XPU_RG1_SCR_ADDR A:0x619362d0
y.create.l HWIO_TCSR_REGS_XPU_RG2_SCR_ADDR A:0x61936350
y.create.l HWIO_TCSR_REGS_XPU_RG3_SCR_ADDR A:0x619363d0
y.create.l HWIO_TCSR_REGS_XPU_RG4_SCR_ADDR A:0x61936450
y.create.l HWIO_TCSR_REGS_XPU_RG5_SCR_ADDR A:0x619364d0
y.create.l HWIO_TCSR_REGS_XPU_RG6_SCR_ADDR A:0x61936550
y.create.l HWIO_TCSR_REGS_XPU_RG7_SCR_ADDR A:0x619365d0
y.create.l HWIO_TCSR_REGS_XPU_RG8_SCR_ADDR A:0x61936650
y.create.l HWIO_TCSR_REGS_XPU_RG9_SCR_ADDR A:0x619366d0
y.create.l HWIO_TCSR_REGS_XPU_RG0_MCR_ADDR A:0x61936254
y.create.l HWIO_TCSR_REGS_XPU_RG1_MCR_ADDR A:0x619362d4
y.create.l HWIO_TCSR_REGS_XPU_RG2_MCR_ADDR A:0x61936354
y.create.l HWIO_TCSR_REGS_XPU_RG3_MCR_ADDR A:0x619363d4
y.create.l HWIO_TCSR_REGS_XPU_RG4_MCR_ADDR A:0x61936454
y.create.l HWIO_TCSR_REGS_XPU_RG5_MCR_ADDR A:0x619364d4
y.create.l HWIO_TCSR_REGS_XPU_RG6_MCR_ADDR A:0x61936554
y.create.l HWIO_TCSR_REGS_XPU_RG7_MCR_ADDR A:0x619365d4
y.create.l HWIO_TCSR_REGS_XPU_RG8_MCR_ADDR A:0x61936654
y.create.l HWIO_TCSR_REGS_XPU_RG9_MCR_ADDR A:0x619366d4
y.create.l HWIO_TCSR_BIMC_CFG_QRIB_XPU2_INIT_ADDR A:0x61937100
y.create.l HWIO_TCSR_BIMC_QXS0_QRIB_XPU2_INIT_ADDR A:0x61937104
y.create.l HWIO_TCSR_MMSS_VENUS0_VBIF_QRIB_XPU2_INIT_ADDR A:0x61937380
y.create.l HWIO_TCSR_MMSS_VENUS0_WRAPPER_QRIB_XPU2_INIT_ADDR A:0x61937384
y.create.l HWIO_TCSR_BIMC_CFG_QRIB_XPU2_ACR_ADDR A:0x61938000
y.create.l HWIO_TCSR_BIMC_CFG_QRIB_XPU2_VMIDEN_INIT_ADDR A:0x61938004
y.create.l HWIO_TCSR_BIMC_QXS0_QRIB_XPU2_ACR_ADDR A:0x61938008
y.create.l HWIO_TCSR_BIMC_QXS0_QRIB_XPU2_VMIDEN_INIT_ADDR A:0x6193800c
y.create.l HWIO_TCSR_MMSS_VENUS0_VBIF_QRIB_XPU2_ACR_ADDR A:0x61938380
y.create.l HWIO_TCSR_MMSS_VENUS0_VBIF_QRIB_XPU2_VMIDEN_INIT_ADDR A:0x61938384
y.create.l HWIO_TCSR_MMSS_VENUS0_WRAPPER_QRIB_XPU2_ACR_ADDR A:0x61938390
y.create.l HWIO_TCSR_MMSS_VENUS0_WRAPPER_QRIB_XPU2_VMIDEN_INIT_ADDR A:0x61938394
y.create.l HWIO_TCSR_SS_XPU2_NON_SEC_INTR0_ADDR A:0x61939000
y.create.l HWIO_TCSR_SS_XPU2_NON_SEC_INTR0_ENABLE_ADDR A:0x61939040
y.create.l HWIO_TCSR_SS_VMIDMT_CLIENT_NON_SEC_INTR_ADDR A:0x61939010
y.create.l HWIO_TCSR_SS_VMIDMT_CLIENT_NON_SEC_INTR_ENABLE_ADDR A:0x61939050
y.create.l HWIO_TCSR_SS_VMIDMT_CFG_NON_SEC_INTR_ADDR A:0x61939090
y.create.l HWIO_TCSR_SS_VMIDMT_CFG_NON_SEC_INTR_ENABLE_ADDR A:0x619390d0
y.create.l HWIO_TCSR_MUTEX_REG_RESET_ADDR A:0x61939800
y.create.l HWIO_TCSR_SS_XPU2_SEC_INTR0_ADDR A:0x61939400
y.create.l HWIO_TCSR_SS_XPU2_SEC_INTR0_ENABLE_ADDR A:0x61939440
y.create.l HWIO_TCSR_SS_VMIDMT_CLIENT_SEC_INTR_ADDR A:0x61939410
y.create.l HWIO_TCSR_SS_VMIDMT_CLIENT_SEC_INTR_ENABLE_ADDR A:0x61939450
y.create.l HWIO_TCSR_SS_VMIDMT_CFG_SEC_INTR_ADDR A:0x61939490
y.create.l HWIO_TCSR_SS_VMIDMT_CFG_SEC_INTR_ENABLE_ADDR A:0x619394d0
y.create.l HWIO_TCSR_SS_XPU2_MSA_INTR0_ADDR A:0x6193a000
y.create.l HWIO_TCSR_SS_XPU2_MSA_INTR0_ENABLE_ADDR A:0x6193a010
y.create.l HWIO_TCSR_MSA_BIT_REG_ADDR A:0x6193a100
y.create.l HWIO_TCSR_TCSR_CLK_EN_ADDR A:0x6193b07c
y.create.l HWIO_TCSR_TIMEOUT_SLAVE_GLB_EN_ADDR A:0x6193c000
y.create.l HWIO_TCSR_XPU_NSEN_STATUS_ADDR A:0x6193c004
y.create.l HWIO_TCSR_XPU_VMIDEN_STATUS_ADDR A:0x6193c008
y.create.l HWIO_TCSR_XPU_MSAEN_STATUS_ADDR A:0x6193c00c
y.create.l HWIO_TCSR_MDP3_TIMEOUT_VAL_0_ADDR_ADDR A:0x6193c014
y.create.l HWIO_TCSR_MDP3_TIMEOUT_VAL_1_ADDR_ADDR A:0x6193c018
y.create.l HWIO_TCSR_MDP3_TIMEOUT_EN_ADDR A:0x6193c01c
y.create.l HWIO_TCSR_TZ_WONCE_0_ADDR A:0x6193d000
y.create.l HWIO_TCSR_TZ_WONCE_1_ADDR A:0x6193d004
y.create.l HWIO_TCSR_TZ_WONCE_2_ADDR A:0x6193d008
y.create.l HWIO_TCSR_TZ_WONCE_3_ADDR A:0x6193d00c
y.create.l HWIO_TCSR_TZ_WONCE_4_ADDR A:0x6193d010
y.create.l HWIO_TCSR_TZ_WONCE_5_ADDR A:0x6193d014
y.create.l HWIO_TCSR_TZ_WONCE_6_ADDR A:0x6193d018
y.create.l HWIO_TCSR_TZ_WONCE_7_ADDR A:0x6193d01c
y.create.l HWIO_TCSR_TZ_WONCE_8_ADDR A:0x6193d020
y.create.l HWIO_TCSR_TZ_WONCE_9_ADDR A:0x6193d024
y.create.l HWIO_TCSR_GCC_CLK_MUX_SEL_ADDR A:0x6193d0f0
y.create.l HWIO_TCSR_BOOT_MISC_DETECT_ADDR A:0x6193d100
y.create.l HWIO_TCSR_APSS_VMID_ADDR A:0x6193d110
y.create.l HWIO_TCSR_MMSS_RPM_IRQ_EN_ADDR A:0x6193e000
y.create.l HWIO_TCSR_MMSS_RPM_IRQ_CLEAR_ADDR A:0x6193e004
y.create.l HWIO_TCSR_MMSS_RPM_IRQ_STATUS_ADDR A:0x6193e008
y.create.l HWIO_TCSR_MMSS_OXILI_GC_SYS_AHB_STATUS_ADDR A:0x6193e010
y.create.l HWIO_TCSR_MMSS_OXILI_CMD_REG_ADDR A:0x6193e014
y.create.l HWIO_TCSR_MMSS_DSI_ULP_CLAMP_CTRL_ADDR A:0x6193e020
y.create.l HWIO_TCSR_MMSS_DSI_PHYRESET_CTRL_ADDR A:0x6193e024
y.create.l HWIO_TCSR_MMSS_IMEM_FSCGC_TIMERS_ADDR A:0x6193e030
y.create.l HWIO_TCSR_MMSS_IMEM_EX_FSCGC_CONTROL_ADDR A:0x6193e034
y.create.l HWIO_TCSR_MMSS_IMEM_RAM_CONFIG_ADDR A:0x6193e038
y.create.l HWIO_TCSR_TBU_BYPASS_ENABLE_ADDR A:0x6193f000
y.create.l HWIO_TCSR_RESET_DEBUG_SW_ENTRY_ADDR A:0x61940000
y.create.l HWIO_TCSR_QPDI_DISABLE_CFG_ADDR A:0x61941000
y.create.l HWIO_TCSR_COMPILER_VDDCX_ACC_0_ADDR A:0x61942080
y.create.l HWIO_TCSR_COMPILER_VDDCX_ACC_1_ADDR A:0x61942084
y.create.l HWIO_TCSR_CUSTOM_VDDCX_ACC_0_ADDR A:0x61942090
y.create.l HWIO_TCSR_CUSTOM_VDDCX_ACC_1_ADDR A:0x61942094
y.create.l HWIO_TCSR_MEM_ACC_SEL_VDDCX_ADDR A:0x61942100
y.create.l HWIO_TCSR_TCSR_S1LM_MODEM_TO_APPS_INT_ADDR A:0x61946000
y.create.l HWIO_TCSR_TCSR_S1LM_MODEM_TO_APPS_INT_DATA_ADDR A:0x61946004
y.create.l HWIO_TCSR_SPARE_APU_REG2_ADDR A:0x61946008
y.create.l HWIO_TCSR_SPARE_APU_REG3_ADDR A:0x6194600c
y.create.l HWIO_TCSR_SYS_POWER_CTRL_ADDR A:0x61947000
y.create.l HWIO_TCSR_USB_CORE_ID_ADDR A:0x61947004
y.create.l HWIO_TCSR_TEST_SPARE_CFG_REG_ADDR_ADDR A:0x61947508
y.create.l HWIO_TCSR_COMPILER_VDDMSS_ACC_0_ADDR A:0x61942104
y.create.l HWIO_TCSR_COMPILER_VDDMSS_ACC_1_ADDR A:0x61942108
y.create.l HWIO_TCSR_COMPILER_VDDAPC_ACC_0_ADDR A:0x6194210c
y.create.l HWIO_TCSR_COMPILER_VDDAPC_ACC_1_ADDR A:0x61942110
y.create.l HWIO_TCSR_CUSTOM_VDDAPC_ACC_0_ADDR A:0x61942120
y.create.l HWIO_TCSR_CUSTOM_VDDAPC_ACC_1_ADDR A:0x61942124
y.create.l HWIO_TCSR_CUSTOM_VDDAPC_ACC_2_ADDR A:0x61942128
y.create.l HWIO_TCSR_MEM_ACC_SEL_VDDMSS_ADDR A:0x6194212c
y.create.l HWIO_TCSR_MEM_ACC_SEL_VDDAPC_ADDR A:0x61942130
y.create.l HWIO_TCSR_CUSTOM_VDDCX_ACC_2_ADDR A:0x61942134
y.create.l HWIO_TCSR_LDO_SLEEP_CTRL_ADDR A:0x61948000
y.create.l HWIO_TCSR_LDO_UPDATE_STATE_CTRL_ADDR A:0x61948004
y.create.l HWIO_TCSR_LDO_OBIAS_CTRL_ADDR A:0x61948008
y.create.l HWIO_TCSR_LDO_VREF_CONFIG_ADDR A:0x6194800c
y.create.l HWIO_TCSR_LDO_IB_CONFIG_ADDR A:0x61948010
y.create.l HWIO_TCSR_LDO_BGC_CONFIG_ADDR A:0x61948014
y.create.l HWIO_TCSR_LDO_VREF_CTRL_ADDR A:0x61948018
y.create.l HWIO_TCSR_LDO_LD_EN_ADDR A:0x6194801c
y.create.l HWIO_TCSR_LDO_LD_CTRL_ADDR A:0x61948020
y.create.l HWIO_TCSR_LDO_OSC_RESETB_ADDR A:0x61948024
y.create.l HWIO_TCSR_LDO_OSC_CTRL_ADDR A:0x61948028
y.create.l HWIO_TCSR_LDO_DFT_EN_CTRL_ADDR A:0x6194802c
y.create.l HWIO_TCSR_LDO_DFT_CTRL_ADDR A:0x61948030
y.create.l HWIO_TCSR_SPDM_CNT_CLK_CTRL_ADDR A:0x6194a000
y.create.l HWIO_TCSR_SPDM_DLY_FIFO_EN_ADDR A:0x6194a004
y.create.l HWIO_TCSR_SPDM_STG1_MUX_SEL_ADDR A:0x6194a008
y.create.l HWIO_TCSR_SPDM_STG2_A_MUX_SEL_ADDR A:0x6194a00c
y.create.l HWIO_TCSR_SPDM_STG2_B_MUX_SEL_ADDR A:0x6194a010
y.create.l HWIO_TCSR_SPDM_STG3_A_MUX_SEL_ADDR A:0x6194a014
y.create.l HWIO_TCSR_SPDM_STG3_B_MUX_SEL_ADDR A:0x6194a018
y.create.l HWIO_TCSR_PHSS_USB2_PHY_SEL_ADDR A:0x6194b000
y.create.l HWIO_TCSR_PHSS_ATEST_USB2_PHY_SEL_ADDR A:0x6194b004
y.create.l HWIO_TCSR_PHSS_TEST_BUS_SEL_ADDR A:0x6194b008
y.create.l HWIO_TCSR_PHSS_UART_PRONTO_INT_SEL_0_ADDR A:0x6194b080
y.create.l HWIO_TCSR_PHSS_UART_PRONTO_INT_SEL_1_ADDR A:0x6194b090
y.create.l HWIO_TCSR_PHSS_UART_MSS_INT_SEL_0_ADDR A:0x6194b0c0
y.create.l HWIO_TCSR_PHSS_UART_MSS_INT_SEL_1_ADDR A:0x6194b0d0
y.create.l HWIO_TCSR_PHSS_QUP_PRONTO_INT_SEL_0_ADDR A:0x6194b100
y.create.l HWIO_TCSR_PHSS_QUP_PRONTO_INT_SEL_1_ADDR A:0x6194b110
y.create.l HWIO_TCSR_PHSS_QUP_MSS_INT_SEL_0_ADDR A:0x6194b140
y.create.l HWIO_TCSR_PHSS_QUP_MSS_INT_SEL_1_ADDR A:0x6194b150
y.create.l HWIO_TCSR_MEM_ARRY_STBY_ADDR A:0x6194c180
y.create.l HWIO_TCSR_SOC_HW_VERSION_ADDR A:0x6194d000
y.create.l HWIO_TCSR_TIMEOUT_INTR_STATUS_ADDR A:0x6194d020
y.create.l HWIO_TCSR_TIMEOUT_INTR_RPM_ENABLE_ADDR A:0x6194d030
y.create.l HWIO_TCSR_TIMEOUT_INTR_APSS_ENABLE_ADDR A:0x6194d040
y.create.l HWIO_TCSR_TIMEOUT_INTR_MSS_ENABLE_ADDR A:0x6194d060
y.create.l HWIO_TCSR_PRONTO_BUS_TIMEOUT_RESET_ADDR A:0x6194d070
y.create.l HWIO_TCSR_CRYPTO0_HALTREQ_ADDR A:0x6194e000
y.create.l HWIO_TCSR_CRYPTO0_HALTACK_ADDR A:0x6194e004
y.create.l HWIO_TCSR_CRYPTO0_MASTER_IDLE_ADDR A:0x6194e008
y.create.l HWIO_TCSR_MSSQ6_HALTREQ_ADDR A:0x6194f000
y.create.l HWIO_TCSR_MSSQ6_HALTACK_ADDR A:0x6194f004
y.create.l HWIO_TCSR_MSSQ6_MASTER_IDLE_ADDR A:0x6194f008
y.create.l HWIO_TCSR_MSSQ6_POWER_STATE_ADDR A:0x6194f010
y.create.l HWIO_TCSR_MSS_MODEM_HALTREQ_ADDR A:0x61950000
y.create.l HWIO_TCSR_MSS_MODEM_HALTACK_ADDR A:0x61950004
y.create.l HWIO_TCSR_MSS_MODEM_MASTER_IDLE_ADDR A:0x61950008
y.create.l HWIO_TCSR_MSS_NC_HALTREQ_ADDR A:0x61951000
y.create.l HWIO_TCSR_MSS_NC_HALTACK_ADDR A:0x61951004
y.create.l HWIO_TCSR_MSS_NC_MASTER_IDLE_ADDR A:0x61951008
y.create.l HWIO_TCSR_WCSS_HALTREQ_ADDR A:0x61952000
y.create.l HWIO_TCSR_WCSS_HALTACK_ADDR A:0x61952004
y.create.l HWIO_TCSR_WCSS_MASTER_IDLE_ADDR A:0x61952008
y.create.l HWIO_TCSR_SDC1_HALTREQ_ADDR A:0x61953000
y.create.l HWIO_TCSR_SDC1_HALTACK_ADDR A:0x61953004
y.create.l HWIO_TCSR_SDC1_MASTER_IDLE_ADDR A:0x61953008
y.create.l HWIO_TCSR_SDC2_HALTREQ_ADDR A:0x61954000
y.create.l HWIO_TCSR_SDC2_HALTACK_ADDR A:0x61954004
y.create.l HWIO_TCSR_SDC2_MASTER_IDLE_ADDR A:0x61954008
y.create.l HWIO_TCSR_ULT_AUDIO_CORE_ABORT_REQ_ADDR A:0x61955000
y.create.l HWIO_TCSR_ULT_AUDIO_CORE_ABORT_ACK_ADDR A:0x61955004
y.create.l HWIO_TCSR_TCSR_S1LM_APPS_TO_MODEM_INT_ADDR A:0x61956000
y.create.l HWIO_TCSR_TCSR_S1LM_APPS_TO_MODEM_INT_DATA_ADDR A:0x61956004
y.create.l HWIO_TCSR_SPARE_REG2_ADDR A:0x61956008
y.create.l HWIO_TCSR_SPARE_REG3_ADDR A:0x6195600c
y.create.l HWIO_TCSR_PNOC_SNOC_MEMTYPE_ADDR A:0x61957000
y.create.l HWIO_CRYPTO0_CRYPTO_VERSION_ADDR A:0x6073a000
y.create.l HWIO_CRYPTO0_CRYPTO_DATA_IN0_ADDR A:0x6073a010
y.create.l HWIO_CRYPTO0_CRYPTO_DATA_IN1_ADDR A:0x6073a014
y.create.l HWIO_CRYPTO0_CRYPTO_DATA_IN2_ADDR A:0x6073a018
y.create.l HWIO_CRYPTO0_CRYPTO_DATA_IN3_ADDR A:0x6073a01c
y.create.l HWIO_CRYPTO0_CRYPTO_DATA_OUT0_ADDR A:0x6073a020
y.create.l HWIO_CRYPTO0_CRYPTO_DATA_OUT1_ADDR A:0x6073a024
y.create.l HWIO_CRYPTO0_CRYPTO_DATA_OUT2_ADDR A:0x6073a028
y.create.l HWIO_CRYPTO0_CRYPTO_DATA_OUT3_ADDR A:0x6073a02c
y.create.l HWIO_CRYPTO0_CRYPTO_STATUS_ADDR A:0x6073a100
y.create.l HWIO_CRYPTO0_CRYPTO_STATUS2_ADDR A:0x6073a104
y.create.l HWIO_CRYPTO0_CRYPTO_BIST_STATUS_ADDR A:0x6073a114
y.create.l HWIO_CRYPTO0_CRYPTO_BIST_FINISH_ADDR A:0x6073a118
y.create.l HWIO_CRYPTO0_CRYPTO_ENGINES_AVAIL_ADDR A:0x6073a108
y.create.l HWIO_CRYPTO0_CRYPTO_FIFO_SIZES_ADDR A:0x6073a10c
y.create.l HWIO_CRYPTO0_CRYPTO_SEG_SIZE_ADDR A:0x6073a110
y.create.l HWIO_CRYPTO0_CRYPTO_GOPROC_ADDR A:0x6073a120
y.create.l HWIO_CRYPTO0_CRYPTO_GOPROC_QC_KEY_ADDR A:0x6073b000
y.create.l HWIO_CRYPTO0_CRYPTO_GOPROC_OEM_KEY_ADDR A:0x6073c000
y.create.l HWIO_CRYPTO0_CRYPTO_ENCR_SEG_CFG_ADDR A:0x6073a200
y.create.l HWIO_CRYPTO0_CRYPTO_ENCR_SEG_SIZE_ADDR A:0x6073a204
y.create.l HWIO_CRYPTO0_CRYPTO_ENCR_SEG_START_ADDR A:0x6073a208
y.create.l HWIO_CRYPTO0_CRYPTO_ENCR_KEY0_ADDR A:0x6073d000
y.create.l HWIO_CRYPTO0_CRYPTO_ENCR_KEY1_ADDR A:0x6073d004
y.create.l HWIO_CRYPTO0_CRYPTO_ENCR_KEY2_ADDR A:0x6073d008
y.create.l HWIO_CRYPTO0_CRYPTO_ENCR_KEY3_ADDR A:0x6073d00c
y.create.l HWIO_CRYPTO0_CRYPTO_ENCR_KEY4_ADDR A:0x6073d010
y.create.l HWIO_CRYPTO0_CRYPTO_ENCR_KEY5_ADDR A:0x6073d014
y.create.l HWIO_CRYPTO0_CRYPTO_ENCR_KEY6_ADDR A:0x6073d018
y.create.l HWIO_CRYPTO0_CRYPTO_ENCR_KEY7_ADDR A:0x6073d01c
y.create.l HWIO_CRYPTO0_CRYPTO_ENCR_PIPE0_KEY0_ADDR A:0x6073e000
y.create.l HWIO_CRYPTO0_CRYPTO_ENCR_PIPE0_KEY1_ADDR A:0x6073e004
y.create.l HWIO_CRYPTO0_CRYPTO_ENCR_PIPE0_KEY2_ADDR A:0x6073e008
y.create.l HWIO_CRYPTO0_CRYPTO_ENCR_PIPE0_KEY3_ADDR A:0x6073e00c
y.create.l HWIO_CRYPTO0_CRYPTO_ENCR_PIPE1_KEY0_ADDR A:0x6073e020
y.create.l HWIO_CRYPTO0_CRYPTO_ENCR_PIPE1_KEY1_ADDR A:0x6073e024
y.create.l HWIO_CRYPTO0_CRYPTO_ENCR_PIPE1_KEY2_ADDR A:0x6073e028
y.create.l HWIO_CRYPTO0_CRYPTO_ENCR_PIPE1_KEY3_ADDR A:0x6073e02c
y.create.l HWIO_CRYPTO0_CRYPTO_ENCR_PIPE2_KEY0_ADDR A:0x6073e040
y.create.l HWIO_CRYPTO0_CRYPTO_ENCR_PIPE2_KEY1_ADDR A:0x6073e044
y.create.l HWIO_CRYPTO0_CRYPTO_ENCR_PIPE2_KEY2_ADDR A:0x6073e048
y.create.l HWIO_CRYPTO0_CRYPTO_ENCR_PIPE2_KEY3_ADDR A:0x6073e04c
y.create.l HWIO_CRYPTO0_CRYPTO_ENCR_PIPE3_KEY0_ADDR A:0x6073e060
y.create.l HWIO_CRYPTO0_CRYPTO_ENCR_PIPE3_KEY1_ADDR A:0x6073e064
y.create.l HWIO_CRYPTO0_CRYPTO_ENCR_PIPE3_KEY2_ADDR A:0x6073e068
y.create.l HWIO_CRYPTO0_CRYPTO_ENCR_PIPE3_KEY3_ADDR A:0x6073e06c
y.create.l HWIO_CRYPTO0_CRYPTO_ENCR_XTS_KEY0_ADDR A:0x6073d020
y.create.l HWIO_CRYPTO0_CRYPTO_ENCR_XTS_KEY1_ADDR A:0x6073d024
y.create.l HWIO_CRYPTO0_CRYPTO_ENCR_XTS_KEY2_ADDR A:0x6073d028
y.create.l HWIO_CRYPTO0_CRYPTO_ENCR_XTS_KEY3_ADDR A:0x6073d02c
y.create.l HWIO_CRYPTO0_CRYPTO_ENCR_XTS_KEY4_ADDR A:0x6073d030
y.create.l HWIO_CRYPTO0_CRYPTO_ENCR_XTS_KEY5_ADDR A:0x6073d034
y.create.l HWIO_CRYPTO0_CRYPTO_ENCR_XTS_KEY6_ADDR A:0x6073d038
y.create.l HWIO_CRYPTO0_CRYPTO_ENCR_XTS_KEY7_ADDR A:0x6073d03c
y.create.l HWIO_CRYPTO0_CRYPTO_ENCR_PIPE0_XTS_KEY0_ADDR A:0x6073e200
y.create.l HWIO_CRYPTO0_CRYPTO_ENCR_PIPE0_XTS_KEY1_ADDR A:0x6073e204
y.create.l HWIO_CRYPTO0_CRYPTO_ENCR_PIPE0_XTS_KEY2_ADDR A:0x6073e208
y.create.l HWIO_CRYPTO0_CRYPTO_ENCR_PIPE0_XTS_KEY3_ADDR A:0x6073e20c
y.create.l HWIO_CRYPTO0_CRYPTO_ENCR_PIPE1_XTS_KEY0_ADDR A:0x6073e220
y.create.l HWIO_CRYPTO0_CRYPTO_ENCR_PIPE1_XTS_KEY1_ADDR A:0x6073e224
y.create.l HWIO_CRYPTO0_CRYPTO_ENCR_PIPE1_XTS_KEY2_ADDR A:0x6073e228
y.create.l HWIO_CRYPTO0_CRYPTO_ENCR_PIPE1_XTS_KEY3_ADDR A:0x6073e22c
y.create.l HWIO_CRYPTO0_CRYPTO_ENCR_PIPE2_XTS_KEY0_ADDR A:0x6073e240
y.create.l HWIO_CRYPTO0_CRYPTO_ENCR_PIPE2_XTS_KEY1_ADDR A:0x6073e244
y.create.l HWIO_CRYPTO0_CRYPTO_ENCR_PIPE2_XTS_KEY2_ADDR A:0x6073e248
y.create.l HWIO_CRYPTO0_CRYPTO_ENCR_PIPE2_XTS_KEY3_ADDR A:0x6073e24c
y.create.l HWIO_CRYPTO0_CRYPTO_ENCR_PIPE3_XTS_KEY0_ADDR A:0x6073e260
y.create.l HWIO_CRYPTO0_CRYPTO_ENCR_PIPE3_XTS_KEY1_ADDR A:0x6073e264
y.create.l HWIO_CRYPTO0_CRYPTO_ENCR_PIPE3_XTS_KEY2_ADDR A:0x6073e268
y.create.l HWIO_CRYPTO0_CRYPTO_ENCR_PIPE3_XTS_KEY3_ADDR A:0x6073e26c
y.create.l HWIO_CRYPTO0_CRYPTO_ENCR_PIPE0_ODD_KEY0_ADDR A:0x6073e400
y.create.l HWIO_CRYPTO0_CRYPTO_ENCR_PIPE0_ODD_KEY1_ADDR A:0x6073e404
y.create.l HWIO_CRYPTO0_CRYPTO_ENCR_PIPE0_ODD_KEY2_ADDR A:0x6073e408
y.create.l HWIO_CRYPTO0_CRYPTO_ENCR_PIPE0_ODD_KEY3_ADDR A:0x6073e40c
y.create.l HWIO_CRYPTO0_CRYPTO_ENCR_PIPE1_ODD_KEY0_ADDR A:0x6073e420
y.create.l HWIO_CRYPTO0_CRYPTO_ENCR_PIPE1_ODD_KEY1_ADDR A:0x6073e424
y.create.l HWIO_CRYPTO0_CRYPTO_ENCR_PIPE1_ODD_KEY2_ADDR A:0x6073e428
y.create.l HWIO_CRYPTO0_CRYPTO_ENCR_PIPE1_ODD_KEY3_ADDR A:0x6073e42c
y.create.l HWIO_CRYPTO0_CRYPTO_ENCR_PIPE2_ODD_KEY0_ADDR A:0x6073e440
y.create.l HWIO_CRYPTO0_CRYPTO_ENCR_PIPE2_ODD_KEY1_ADDR A:0x6073e444
y.create.l HWIO_CRYPTO0_CRYPTO_ENCR_PIPE2_ODD_KEY2_ADDR A:0x6073e448
y.create.l HWIO_CRYPTO0_CRYPTO_ENCR_PIPE2_ODD_KEY3_ADDR A:0x6073e44c
y.create.l HWIO_CRYPTO0_CRYPTO_ENCR_PIPE3_ODD_KEY0_ADDR A:0x6073e460
y.create.l HWIO_CRYPTO0_CRYPTO_ENCR_PIPE3_ODD_KEY1_ADDR A:0x6073e464
y.create.l HWIO_CRYPTO0_CRYPTO_ENCR_PIPE3_ODD_KEY2_ADDR A:0x6073e468
y.create.l HWIO_CRYPTO0_CRYPTO_ENCR_PIPE3_ODD_KEY3_ADDR A:0x6073e46c
y.create.l HWIO_CRYPTO0_CRYPTO_ENCR_PIPE0_XTS_ODD_KEY0_ADDR A:0x6073e600
y.create.l HWIO_CRYPTO0_CRYPTO_ENCR_PIPE0_XTS_ODD_KEY1_ADDR A:0x6073e604
y.create.l HWIO_CRYPTO0_CRYPTO_ENCR_PIPE0_XTS_ODD_KEY2_ADDR A:0x6073e608
y.create.l HWIO_CRYPTO0_CRYPTO_ENCR_PIPE0_XTS_ODD_KEY3_ADDR A:0x6073e60c
y.create.l HWIO_CRYPTO0_CRYPTO_ENCR_PIPE1_XTS_ODD_KEY0_ADDR A:0x6073e620
y.create.l HWIO_CRYPTO0_CRYPTO_ENCR_PIPE1_XTS_ODD_KEY1_ADDR A:0x6073e624
y.create.l HWIO_CRYPTO0_CRYPTO_ENCR_PIPE1_XTS_ODD_KEY2_ADDR A:0x6073e628
y.create.l HWIO_CRYPTO0_CRYPTO_ENCR_PIPE1_XTS_ODD_KEY3_ADDR A:0x6073e62c
y.create.l HWIO_CRYPTO0_CRYPTO_ENCR_PIPE2_XTS_ODD_KEY0_ADDR A:0x6073e640
y.create.l HWIO_CRYPTO0_CRYPTO_ENCR_PIPE2_XTS_ODD_KEY1_ADDR A:0x6073e644
y.create.l HWIO_CRYPTO0_CRYPTO_ENCR_PIPE2_XTS_ODD_KEY2_ADDR A:0x6073e648
y.create.l HWIO_CRYPTO0_CRYPTO_ENCR_PIPE2_XTS_ODD_KEY3_ADDR A:0x6073e64c
y.create.l HWIO_CRYPTO0_CRYPTO_ENCR_PIPE3_XTS_ODD_KEY0_ADDR A:0x6073e660
y.create.l HWIO_CRYPTO0_CRYPTO_ENCR_PIPE3_XTS_ODD_KEY1_ADDR A:0x6073e664
y.create.l HWIO_CRYPTO0_CRYPTO_ENCR_PIPE3_XTS_ODD_KEY2_ADDR A:0x6073e668
y.create.l HWIO_CRYPTO0_CRYPTO_ENCR_PIPE3_XTS_ODD_KEY3_ADDR A:0x6073e66c
y.create.l HWIO_CRYPTO0_CRYPTO_ENCR_CNTR0_IV0_ADDR A:0x6073a20c
y.create.l HWIO_CRYPTO0_CRYPTO_ENCR_CNTR1_IV1_ADDR A:0x6073a210
y.create.l HWIO_CRYPTO0_CRYPTO_ENCR_CNTR2_IV2_ADDR A:0x6073a214
y.create.l HWIO_CRYPTO0_CRYPTO_ENCR_CNTR3_IV3_ADDR A:0x6073a218
y.create.l HWIO_CRYPTO0_CRYPTO_ENCR_CNTR_MASK_ADDR A:0x6073a21c
y.create.l HWIO_CRYPTO0_CRYPTO_ENCR_CNTR_MASK2_ADDR A:0x6073a234
y.create.l HWIO_CRYPTO0_CRYPTO_ENCR_CNTR_MASK1_ADDR A:0x6073a238
y.create.l HWIO_CRYPTO0_CRYPTO_ENCR_CNTR_MASK0_ADDR A:0x6073a23c
y.create.l HWIO_CRYPTO0_CRYPTO_ENCR_CCM_INIT_CNTR0_ADDR A:0x6073a220
y.create.l HWIO_CRYPTO0_CRYPTO_ENCR_CCM_INIT_CNTR1_ADDR A:0x6073a224
y.create.l HWIO_CRYPTO0_CRYPTO_ENCR_CCM_INIT_CNTR2_ADDR A:0x6073a228
y.create.l HWIO_CRYPTO0_CRYPTO_ENCR_CCM_INIT_CNTR3_ADDR A:0x6073a22c
y.create.l HWIO_CRYPTO0_CRYPTO_ENCR_XTS_DU_SIZE_ADDR A:0x6073a230
y.create.l HWIO_CRYPTO0_CRYPTO_AUTH_SEG_CFG_ADDR A:0x6073a300
y.create.l HWIO_CRYPTO0_CRYPTO_AUTH_SEG_SIZE_ADDR A:0x6073a304
y.create.l HWIO_CRYPTO0_CRYPTO_AUTH_SEG_START_ADDR A:0x6073a308
y.create.l HWIO_CRYPTO0_CRYPTO_AUTH_KEY0_ADDR A:0x6073d040
y.create.l HWIO_CRYPTO0_CRYPTO_AUTH_KEY1_ADDR A:0x6073d044
y.create.l HWIO_CRYPTO0_CRYPTO_AUTH_KEY2_ADDR A:0x6073d048
y.create.l HWIO_CRYPTO0_CRYPTO_AUTH_KEY3_ADDR A:0x6073d04c
y.create.l HWIO_CRYPTO0_CRYPTO_AUTH_KEY4_ADDR A:0x6073d050
y.create.l HWIO_CRYPTO0_CRYPTO_AUTH_KEY5_ADDR A:0x6073d054
y.create.l HWIO_CRYPTO0_CRYPTO_AUTH_KEY6_ADDR A:0x6073d058
y.create.l HWIO_CRYPTO0_CRYPTO_AUTH_KEY7_ADDR A:0x6073d05c
y.create.l HWIO_CRYPTO0_CRYPTO_AUTH_KEY8_ADDR A:0x6073d060
y.create.l HWIO_CRYPTO0_CRYPTO_AUTH_KEY9_ADDR A:0x6073d064
y.create.l HWIO_CRYPTO0_CRYPTO_AUTH_PIPE0_KEY0_ADDR A:0x6073e800
y.create.l HWIO_CRYPTO0_CRYPTO_AUTH_PIPE0_KEY1_ADDR A:0x6073e804
y.create.l HWIO_CRYPTO0_CRYPTO_AUTH_PIPE0_KEY2_ADDR A:0x6073e808
y.create.l HWIO_CRYPTO0_CRYPTO_AUTH_PIPE0_KEY3_ADDR A:0x6073e80c
y.create.l HWIO_CRYPTO0_CRYPTO_AUTH_PIPE1_KEY0_ADDR A:0x6073e880
y.create.l HWIO_CRYPTO0_CRYPTO_AUTH_PIPE1_KEY1_ADDR A:0x6073e884
y.create.l HWIO_CRYPTO0_CRYPTO_AUTH_PIPE1_KEY2_ADDR A:0x6073e888
y.create.l HWIO_CRYPTO0_CRYPTO_AUTH_PIPE1_KEY3_ADDR A:0x6073e88c
y.create.l HWIO_CRYPTO0_CRYPTO_AUTH_PIPE2_KEY0_ADDR A:0x6073e900
y.create.l HWIO_CRYPTO0_CRYPTO_AUTH_PIPE2_KEY1_ADDR A:0x6073e904
y.create.l HWIO_CRYPTO0_CRYPTO_AUTH_PIPE2_KEY2_ADDR A:0x6073e908
y.create.l HWIO_CRYPTO0_CRYPTO_AUTH_PIPE2_KEY3_ADDR A:0x6073e90c
y.create.l HWIO_CRYPTO0_CRYPTO_AUTH_PIPE3_KEY0_ADDR A:0x6073e980
y.create.l HWIO_CRYPTO0_CRYPTO_AUTH_PIPE3_KEY1_ADDR A:0x6073e984
y.create.l HWIO_CRYPTO0_CRYPTO_AUTH_PIPE3_KEY2_ADDR A:0x6073e988
y.create.l HWIO_CRYPTO0_CRYPTO_AUTH_PIPE3_KEY3_ADDR A:0x6073e98c
y.create.l HWIO_CRYPTO0_CRYPTO_AUTH_IV0_ADDR A:0x6073a310
y.create.l HWIO_CRYPTO0_CRYPTO_AUTH_IV1_ADDR A:0x6073a314
y.create.l HWIO_CRYPTO0_CRYPTO_AUTH_IV2_ADDR A:0x6073a318
y.create.l HWIO_CRYPTO0_CRYPTO_AUTH_IV3_ADDR A:0x6073a31c
y.create.l HWIO_CRYPTO0_CRYPTO_AUTH_IV4_ADDR A:0x6073a320
y.create.l HWIO_CRYPTO0_CRYPTO_AUTH_IV5_ADDR A:0x6073a324
y.create.l HWIO_CRYPTO0_CRYPTO_AUTH_IV6_ADDR A:0x6073a328
y.create.l HWIO_CRYPTO0_CRYPTO_AUTH_IV7_ADDR A:0x6073a32c
y.create.l HWIO_CRYPTO0_CRYPTO_AUTH_INFO_NONCE0_ADDR A:0x6073a350
y.create.l HWIO_CRYPTO0_CRYPTO_AUTH_INFO_NONCE1_ADDR A:0x6073a354
y.create.l HWIO_CRYPTO0_CRYPTO_AUTH_INFO_NONCE2_ADDR A:0x6073a358
y.create.l HWIO_CRYPTO0_CRYPTO_AUTH_INFO_NONCE3_ADDR A:0x6073a35c
y.create.l HWIO_CRYPTO0_CRYPTO_AUTH_BYTECNT0_ADDR A:0x6073a390
y.create.l HWIO_CRYPTO0_CRYPTO_AUTH_BYTECNT1_ADDR A:0x6073a394
y.create.l HWIO_CRYPTO0_CRYPTO_AUTH_EXP_MAC0_ADDR A:0x6073a3a0
y.create.l HWIO_CRYPTO0_CRYPTO_AUTH_EXP_MAC1_ADDR A:0x6073a3a4
y.create.l HWIO_CRYPTO0_CRYPTO_AUTH_EXP_MAC2_ADDR A:0x6073a3a8
y.create.l HWIO_CRYPTO0_CRYPTO_AUTH_EXP_MAC3_ADDR A:0x6073a3ac
y.create.l HWIO_CRYPTO0_CRYPTO_AUTH_EXP_MAC4_ADDR A:0x6073a3b0
y.create.l HWIO_CRYPTO0_CRYPTO_AUTH_EXP_MAC5_ADDR A:0x6073a3b4
y.create.l HWIO_CRYPTO0_CRYPTO_AUTH_EXP_MAC6_ADDR A:0x6073a3b8
y.create.l HWIO_CRYPTO0_CRYPTO_AUTH_EXP_MAC7_ADDR A:0x6073a3bc
y.create.l HWIO_CRYPTO0_CRYPTO_CONFIG_ADDR A:0x6073a400
y.create.l HWIO_CRYPTO0_CRYPTO_DEBUG_ENABLE_ADDR A:0x6073f000
y.create.l HWIO_CRYPTO0_CRYPTO_DEBUG_ADDR A:0x6073f004
y.create.l HWIO_CRYPTO0_CRYPTO_PWR_CTRL_ADDR A:0x6073f008
y.create.l HWIO_CRYPTO0_CRYPTO_BAM_CTRL_ADDR A:0x60704000
y.create.l HWIO_CRYPTO0_CRYPTO_BAM_TIMER_ADDR A:0x60704040
y.create.l HWIO_CRYPTO0_CRYPTO_BAM_TIMER_CTRL_ADDR A:0x60704044
y.create.l HWIO_CRYPTO0_CRYPTO_BAM_DESC_CNT_TRSHLD_ADDR A:0x60704008
y.create.l HWIO_CRYPTO0_CRYPTO_BAM_IRQ_STTS_ADDR A:0x60704014
y.create.l HWIO_CRYPTO0_CRYPTO_BAM_IRQ_CLR_ADDR A:0x60704018
y.create.l HWIO_CRYPTO0_CRYPTO_BAM_IRQ_EN_ADDR A:0x6070401c
y.create.l HWIO_CRYPTO0_CRYPTO_BAM_CNFG_BITS_ADDR A:0x6070407c
y.create.l HWIO_CRYPTO0_CRYPTO_BAM_CNFG_BITS_2_ADDR A:0x60704084
y.create.l HWIO_CRYPTO0_CRYPTO_BAM_REVISION_ADDR A:0x60705000
y.create.l HWIO_CRYPTO0_CRYPTO_BAM_SW_VERSION_ADDR A:0x60705004
y.create.l HWIO_CRYPTO0_CRYPTO_BAM_NUM_PIPES_ADDR A:0x60705008
y.create.l HWIO_CRYPTO0_CRYPTO_BAM_TEST_BUS_SEL_ADDR A:0x60705010
y.create.l HWIO_CRYPTO0_CRYPTO_BAM_TEST_BUS_REG_ADDR A:0x60705014
y.create.l HWIO_CRYPTO0_CRYPTO_BAM_AHB_MASTER_ERR_CTRLS_ADDR A:0x60705024
y.create.l HWIO_CRYPTO0_CRYPTO_BAM_AHB_MASTER_ERR_ADDR_ADDR A:0x60705028
y.create.l HWIO_CRYPTO0_CRYPTO_BAM_AHB_MASTER_ERR_DATA_ADDR A:0x6070502c
y.create.l HWIO_CRYPTO0_CRYPTO_BAM_AHB_MASTER_ERR_ADDR_LSB_ADDR A:0x60705100
y.create.l HWIO_CRYPTO0_CRYPTO_BAM_AHB_MASTER_ERR_ADDR_MSB_ADDR A:0x60705104
y.create.l HWIO_CRYPTO0_CRYPTO_BAM_TRUST_REG_ADDR A:0x60706000
y.create.l HWIO_CRYPTO0_CRYPTO_BAM_P_TRUST_REG0_ADDR A:0x60706020
y.create.l HWIO_CRYPTO0_CRYPTO_BAM_P_TRUST_REG1_ADDR A:0x60706024
y.create.l HWIO_CRYPTO0_CRYPTO_BAM_P_TRUST_REG2_ADDR A:0x60706028
y.create.l HWIO_CRYPTO0_CRYPTO_BAM_P_TRUST_REG3_ADDR A:0x6070602c
y.create.l HWIO_CRYPTO0_CRYPTO_BAM_P_TRUST_REG4_ADDR A:0x60706030
y.create.l HWIO_CRYPTO0_CRYPTO_BAM_P_TRUST_REG5_ADDR A:0x60706034
y.create.l HWIO_CRYPTO0_CRYPTO_BAM_P_TRUST_REG6_ADDR A:0x60706038
y.create.l HWIO_CRYPTO0_CRYPTO_BAM_P_TRUST_REG7_ADDR A:0x6070603c
y.create.l HWIO_CRYPTO0_CRYPTO_BAM_IRQ_SRCS_EE0_ADDR A:0x60707000
y.create.l HWIO_CRYPTO0_CRYPTO_BAM_IRQ_SRCS_EE1_ADDR A:0x60708000
y.create.l HWIO_CRYPTO0_CRYPTO_BAM_IRQ_SRCS_EE2_ADDR A:0x60709000
y.create.l HWIO_CRYPTO0_CRYPTO_BAM_IRQ_SRCS_EE3_ADDR A:0x6070a000
y.create.l HWIO_CRYPTO0_CRYPTO_BAM_IRQ_SRCS_EE4_ADDR A:0x6070b000
y.create.l HWIO_CRYPTO0_CRYPTO_BAM_IRQ_SRCS_EE5_ADDR A:0x6070c000
y.create.l HWIO_CRYPTO0_CRYPTO_BAM_IRQ_SRCS_EE6_ADDR A:0x6070d000
y.create.l HWIO_CRYPTO0_CRYPTO_BAM_IRQ_SRCS_EE7_ADDR A:0x6070e000
y.create.l HWIO_CRYPTO0_CRYPTO_BAM_IRQ_SRCS_MSK_EE0_ADDR A:0x60707004
y.create.l HWIO_CRYPTO0_CRYPTO_BAM_IRQ_SRCS_MSK_EE1_ADDR A:0x60708004
y.create.l HWIO_CRYPTO0_CRYPTO_BAM_IRQ_SRCS_MSK_EE2_ADDR A:0x60709004
y.create.l HWIO_CRYPTO0_CRYPTO_BAM_IRQ_SRCS_MSK_EE3_ADDR A:0x6070a004
y.create.l HWIO_CRYPTO0_CRYPTO_BAM_IRQ_SRCS_MSK_EE4_ADDR A:0x6070b004
y.create.l HWIO_CRYPTO0_CRYPTO_BAM_IRQ_SRCS_MSK_EE5_ADDR A:0x6070c004
y.create.l HWIO_CRYPTO0_CRYPTO_BAM_IRQ_SRCS_MSK_EE6_ADDR A:0x6070d004
y.create.l HWIO_CRYPTO0_CRYPTO_BAM_IRQ_SRCS_MSK_EE7_ADDR A:0x6070e004
y.create.l HWIO_CRYPTO0_CRYPTO_BAM_IRQ_SRCS_UNMASKED_EE0_ADDR A:0x60707008
y.create.l HWIO_CRYPTO0_CRYPTO_BAM_IRQ_SRCS_UNMASKED_EE1_ADDR A:0x60708008
y.create.l HWIO_CRYPTO0_CRYPTO_BAM_IRQ_SRCS_UNMASKED_EE2_ADDR A:0x60709008
y.create.l HWIO_CRYPTO0_CRYPTO_BAM_IRQ_SRCS_UNMASKED_EE3_ADDR A:0x6070a008
y.create.l HWIO_CRYPTO0_CRYPTO_BAM_IRQ_SRCS_UNMASKED_EE4_ADDR A:0x6070b008
y.create.l HWIO_CRYPTO0_CRYPTO_BAM_IRQ_SRCS_UNMASKED_EE5_ADDR A:0x6070c008
y.create.l HWIO_CRYPTO0_CRYPTO_BAM_IRQ_SRCS_UNMASKED_EE6_ADDR A:0x6070d008
y.create.l HWIO_CRYPTO0_CRYPTO_BAM_IRQ_SRCS_UNMASKED_EE7_ADDR A:0x6070e008
y.create.l HWIO_CRYPTO0_CRYPTO_BAM_PIPE_ATTR_EE0_ADDR A:0x6070700c
y.create.l HWIO_CRYPTO0_CRYPTO_BAM_PIPE_ATTR_EE1_ADDR A:0x6070800c
y.create.l HWIO_CRYPTO0_CRYPTO_BAM_PIPE_ATTR_EE2_ADDR A:0x6070900c
y.create.l HWIO_CRYPTO0_CRYPTO_BAM_PIPE_ATTR_EE3_ADDR A:0x6070a00c
y.create.l HWIO_CRYPTO0_CRYPTO_BAM_PIPE_ATTR_EE4_ADDR A:0x6070b00c
y.create.l HWIO_CRYPTO0_CRYPTO_BAM_PIPE_ATTR_EE5_ADDR A:0x6070c00c
y.create.l HWIO_CRYPTO0_CRYPTO_BAM_PIPE_ATTR_EE6_ADDR A:0x6070d00c
y.create.l HWIO_CRYPTO0_CRYPTO_BAM_PIPE_ATTR_EE7_ADDR A:0x6070e00c
y.create.l HWIO_CRYPTO0_CRYPTO_BAM_IRQ_SRCS_ADDR A:0x60707010
y.create.l HWIO_CRYPTO0_CRYPTO_BAM_IRQ_SRCS_MSK_ADDR A:0x60707014
y.create.l HWIO_CRYPTO0_CRYPTO_BAM_IRQ_SRCS_UNMASKED_ADDR A:0x60707018
y.create.l HWIO_CRYPTO0_CRYPTO_BAM_P_CTRL0_ADDR A:0x60717000
y.create.l HWIO_CRYPTO0_CRYPTO_BAM_P_CTRL1_ADDR A:0x60718000
y.create.l HWIO_CRYPTO0_CRYPTO_BAM_P_CTRL2_ADDR A:0x60719000
y.create.l HWIO_CRYPTO0_CRYPTO_BAM_P_CTRL3_ADDR A:0x6071a000
y.create.l HWIO_CRYPTO0_CRYPTO_BAM_P_CTRL4_ADDR A:0x6071b000
y.create.l HWIO_CRYPTO0_CRYPTO_BAM_P_CTRL5_ADDR A:0x6071c000
y.create.l HWIO_CRYPTO0_CRYPTO_BAM_P_CTRL6_ADDR A:0x6071d000
y.create.l HWIO_CRYPTO0_CRYPTO_BAM_P_CTRL7_ADDR A:0x6071e000
y.create.l HWIO_CRYPTO0_CRYPTO_BAM_P_RST0_ADDR A:0x60717004
y.create.l HWIO_CRYPTO0_CRYPTO_BAM_P_RST1_ADDR A:0x60718004
y.create.l HWIO_CRYPTO0_CRYPTO_BAM_P_RST2_ADDR A:0x60719004
y.create.l HWIO_CRYPTO0_CRYPTO_BAM_P_RST3_ADDR A:0x6071a004
y.create.l HWIO_CRYPTO0_CRYPTO_BAM_P_RST4_ADDR A:0x6071b004
y.create.l HWIO_CRYPTO0_CRYPTO_BAM_P_RST5_ADDR A:0x6071c004
y.create.l HWIO_CRYPTO0_CRYPTO_BAM_P_RST6_ADDR A:0x6071d004
y.create.l HWIO_CRYPTO0_CRYPTO_BAM_P_RST7_ADDR A:0x6071e004
y.create.l HWIO_CRYPTO0_CRYPTO_BAM_P_HALT0_ADDR A:0x60717008
y.create.l HWIO_CRYPTO0_CRYPTO_BAM_P_HALT1_ADDR A:0x60718008
y.create.l HWIO_CRYPTO0_CRYPTO_BAM_P_HALT2_ADDR A:0x60719008
y.create.l HWIO_CRYPTO0_CRYPTO_BAM_P_HALT3_ADDR A:0x6071a008
y.create.l HWIO_CRYPTO0_CRYPTO_BAM_P_HALT4_ADDR A:0x6071b008
y.create.l HWIO_CRYPTO0_CRYPTO_BAM_P_HALT5_ADDR A:0x6071c008
y.create.l HWIO_CRYPTO0_CRYPTO_BAM_P_HALT6_ADDR A:0x6071d008
y.create.l HWIO_CRYPTO0_CRYPTO_BAM_P_HALT7_ADDR A:0x6071e008
y.create.l HWIO_CRYPTO0_CRYPTO_BAM_P_IRQ_STTS0_ADDR A:0x60717010
y.create.l HWIO_CRYPTO0_CRYPTO_BAM_P_IRQ_STTS1_ADDR A:0x60718010
y.create.l HWIO_CRYPTO0_CRYPTO_BAM_P_IRQ_STTS2_ADDR A:0x60719010
y.create.l HWIO_CRYPTO0_CRYPTO_BAM_P_IRQ_STTS3_ADDR A:0x6071a010
y.create.l HWIO_CRYPTO0_CRYPTO_BAM_P_IRQ_STTS4_ADDR A:0x6071b010
y.create.l HWIO_CRYPTO0_CRYPTO_BAM_P_IRQ_STTS5_ADDR A:0x6071c010
y.create.l HWIO_CRYPTO0_CRYPTO_BAM_P_IRQ_STTS6_ADDR A:0x6071d010
y.create.l HWIO_CRYPTO0_CRYPTO_BAM_P_IRQ_STTS7_ADDR A:0x6071e010
y.create.l HWIO_CRYPTO0_CRYPTO_BAM_P_IRQ_CLR0_ADDR A:0x60717014
y.create.l HWIO_CRYPTO0_CRYPTO_BAM_P_IRQ_CLR1_ADDR A:0x60718014
y.create.l HWIO_CRYPTO0_CRYPTO_BAM_P_IRQ_CLR2_ADDR A:0x60719014
y.create.l HWIO_CRYPTO0_CRYPTO_BAM_P_IRQ_CLR3_ADDR A:0x6071a014
y.create.l HWIO_CRYPTO0_CRYPTO_BAM_P_IRQ_CLR4_ADDR A:0x6071b014
y.create.l HWIO_CRYPTO0_CRYPTO_BAM_P_IRQ_CLR5_ADDR A:0x6071c014
y.create.l HWIO_CRYPTO0_CRYPTO_BAM_P_IRQ_CLR6_ADDR A:0x6071d014
y.create.l HWIO_CRYPTO0_CRYPTO_BAM_P_IRQ_CLR7_ADDR A:0x6071e014
y.create.l HWIO_CRYPTO0_CRYPTO_BAM_P_IRQ_EN0_ADDR A:0x60717018
y.create.l HWIO_CRYPTO0_CRYPTO_BAM_P_IRQ_EN1_ADDR A:0x60718018
y.create.l HWIO_CRYPTO0_CRYPTO_BAM_P_IRQ_EN2_ADDR A:0x60719018
y.create.l HWIO_CRYPTO0_CRYPTO_BAM_P_IRQ_EN3_ADDR A:0x6071a018
y.create.l HWIO_CRYPTO0_CRYPTO_BAM_P_IRQ_EN4_ADDR A:0x6071b018
y.create.l HWIO_CRYPTO0_CRYPTO_BAM_P_IRQ_EN5_ADDR A:0x6071c018
y.create.l HWIO_CRYPTO0_CRYPTO_BAM_P_IRQ_EN6_ADDR A:0x6071d018
y.create.l HWIO_CRYPTO0_CRYPTO_BAM_P_IRQ_EN7_ADDR A:0x6071e018
y.create.l HWIO_CRYPTO0_CRYPTO_BAM_P_TIMER0_ADDR A:0x6071701c
y.create.l HWIO_CRYPTO0_CRYPTO_BAM_P_TIMER1_ADDR A:0x6071801c
y.create.l HWIO_CRYPTO0_CRYPTO_BAM_P_TIMER2_ADDR A:0x6071901c
y.create.l HWIO_CRYPTO0_CRYPTO_BAM_P_TIMER3_ADDR A:0x6071a01c
y.create.l HWIO_CRYPTO0_CRYPTO_BAM_P_TIMER4_ADDR A:0x6071b01c
y.create.l HWIO_CRYPTO0_CRYPTO_BAM_P_TIMER5_ADDR A:0x6071c01c
y.create.l HWIO_CRYPTO0_CRYPTO_BAM_P_TIMER6_ADDR A:0x6071d01c
y.create.l HWIO_CRYPTO0_CRYPTO_BAM_P_TIMER7_ADDR A:0x6071e01c
y.create.l HWIO_CRYPTO0_CRYPTO_BAM_P_TIMER_CTRL0_ADDR A:0x60717020
y.create.l HWIO_CRYPTO0_CRYPTO_BAM_P_TIMER_CTRL1_ADDR A:0x60718020
y.create.l HWIO_CRYPTO0_CRYPTO_BAM_P_TIMER_CTRL2_ADDR A:0x60719020
y.create.l HWIO_CRYPTO0_CRYPTO_BAM_P_TIMER_CTRL3_ADDR A:0x6071a020
y.create.l HWIO_CRYPTO0_CRYPTO_BAM_P_TIMER_CTRL4_ADDR A:0x6071b020
y.create.l HWIO_CRYPTO0_CRYPTO_BAM_P_TIMER_CTRL5_ADDR A:0x6071c020
y.create.l HWIO_CRYPTO0_CRYPTO_BAM_P_TIMER_CTRL6_ADDR A:0x6071d020
y.create.l HWIO_CRYPTO0_CRYPTO_BAM_P_TIMER_CTRL7_ADDR A:0x6071e020
y.create.l HWIO_CRYPTO0_CRYPTO_BAM_P_PRDCR_SDBND0_ADDR A:0x60717024
y.create.l HWIO_CRYPTO0_CRYPTO_BAM_P_PRDCR_SDBND1_ADDR A:0x60718024
y.create.l HWIO_CRYPTO0_CRYPTO_BAM_P_PRDCR_SDBND2_ADDR A:0x60719024
y.create.l HWIO_CRYPTO0_CRYPTO_BAM_P_PRDCR_SDBND3_ADDR A:0x6071a024
y.create.l HWIO_CRYPTO0_CRYPTO_BAM_P_PRDCR_SDBND4_ADDR A:0x6071b024
y.create.l HWIO_CRYPTO0_CRYPTO_BAM_P_PRDCR_SDBND5_ADDR A:0x6071c024
y.create.l HWIO_CRYPTO0_CRYPTO_BAM_P_PRDCR_SDBND6_ADDR A:0x6071d024
y.create.l HWIO_CRYPTO0_CRYPTO_BAM_P_PRDCR_SDBND7_ADDR A:0x6071e024
y.create.l HWIO_CRYPTO0_CRYPTO_BAM_P_CNSMR_SDBND0_ADDR A:0x60717028
y.create.l HWIO_CRYPTO0_CRYPTO_BAM_P_CNSMR_SDBND1_ADDR A:0x60718028
y.create.l HWIO_CRYPTO0_CRYPTO_BAM_P_CNSMR_SDBND2_ADDR A:0x60719028
y.create.l HWIO_CRYPTO0_CRYPTO_BAM_P_CNSMR_SDBND3_ADDR A:0x6071a028
y.create.l HWIO_CRYPTO0_CRYPTO_BAM_P_CNSMR_SDBND4_ADDR A:0x6071b028
y.create.l HWIO_CRYPTO0_CRYPTO_BAM_P_CNSMR_SDBND5_ADDR A:0x6071c028
y.create.l HWIO_CRYPTO0_CRYPTO_BAM_P_CNSMR_SDBND6_ADDR A:0x6071d028
y.create.l HWIO_CRYPTO0_CRYPTO_BAM_P_CNSMR_SDBND7_ADDR A:0x6071e028
y.create.l HWIO_CRYPTO0_CRYPTO_BAM_P_SW_OFSTS0_ADDR A:0x60717800
y.create.l HWIO_CRYPTO0_CRYPTO_BAM_P_SW_OFSTS1_ADDR A:0x60718800
y.create.l HWIO_CRYPTO0_CRYPTO_BAM_P_SW_OFSTS2_ADDR A:0x60719800
y.create.l HWIO_CRYPTO0_CRYPTO_BAM_P_SW_OFSTS3_ADDR A:0x6071a800
y.create.l HWIO_CRYPTO0_CRYPTO_BAM_P_SW_OFSTS4_ADDR A:0x6071b800
y.create.l HWIO_CRYPTO0_CRYPTO_BAM_P_SW_OFSTS5_ADDR A:0x6071c800
y.create.l HWIO_CRYPTO0_CRYPTO_BAM_P_SW_OFSTS6_ADDR A:0x6071d800
y.create.l HWIO_CRYPTO0_CRYPTO_BAM_P_SW_OFSTS7_ADDR A:0x6071e800
y.create.l HWIO_CRYPTO0_CRYPTO_BAM_P_AU_PSM_CNTXT_1_0_ADDR A:0x60717804
y.create.l HWIO_CRYPTO0_CRYPTO_BAM_P_AU_PSM_CNTXT_1_1_ADDR A:0x60718804
y.create.l HWIO_CRYPTO0_CRYPTO_BAM_P_AU_PSM_CNTXT_1_2_ADDR A:0x60719804
y.create.l HWIO_CRYPTO0_CRYPTO_BAM_P_AU_PSM_CNTXT_1_3_ADDR A:0x6071a804
y.create.l HWIO_CRYPTO0_CRYPTO_BAM_P_AU_PSM_CNTXT_1_4_ADDR A:0x6071b804
y.create.l HWIO_CRYPTO0_CRYPTO_BAM_P_AU_PSM_CNTXT_1_5_ADDR A:0x6071c804
y.create.l HWIO_CRYPTO0_CRYPTO_BAM_P_AU_PSM_CNTXT_1_6_ADDR A:0x6071d804
y.create.l HWIO_CRYPTO0_CRYPTO_BAM_P_AU_PSM_CNTXT_1_7_ADDR A:0x6071e804
y.create.l HWIO_CRYPTO0_CRYPTO_BAM_P_PSM_CNTXT_2_0_ADDR A:0x60717808
y.create.l HWIO_CRYPTO0_CRYPTO_BAM_P_PSM_CNTXT_2_1_ADDR A:0x60718808
y.create.l HWIO_CRYPTO0_CRYPTO_BAM_P_PSM_CNTXT_2_2_ADDR A:0x60719808
y.create.l HWIO_CRYPTO0_CRYPTO_BAM_P_PSM_CNTXT_2_3_ADDR A:0x6071a808
y.create.l HWIO_CRYPTO0_CRYPTO_BAM_P_PSM_CNTXT_2_4_ADDR A:0x6071b808
y.create.l HWIO_CRYPTO0_CRYPTO_BAM_P_PSM_CNTXT_2_5_ADDR A:0x6071c808
y.create.l HWIO_CRYPTO0_CRYPTO_BAM_P_PSM_CNTXT_2_6_ADDR A:0x6071d808
y.create.l HWIO_CRYPTO0_CRYPTO_BAM_P_PSM_CNTXT_2_7_ADDR A:0x6071e808
y.create.l HWIO_CRYPTO0_CRYPTO_BAM_P_PSM_CNTXT_3_0_ADDR A:0x6071780c
y.create.l HWIO_CRYPTO0_CRYPTO_BAM_P_PSM_CNTXT_3_1_ADDR A:0x6071880c
y.create.l HWIO_CRYPTO0_CRYPTO_BAM_P_PSM_CNTXT_3_2_ADDR A:0x6071980c
y.create.l HWIO_CRYPTO0_CRYPTO_BAM_P_PSM_CNTXT_3_3_ADDR A:0x6071a80c
y.create.l HWIO_CRYPTO0_CRYPTO_BAM_P_PSM_CNTXT_3_4_ADDR A:0x6071b80c
y.create.l HWIO_CRYPTO0_CRYPTO_BAM_P_PSM_CNTXT_3_5_ADDR A:0x6071c80c
y.create.l HWIO_CRYPTO0_CRYPTO_BAM_P_PSM_CNTXT_3_6_ADDR A:0x6071d80c
y.create.l HWIO_CRYPTO0_CRYPTO_BAM_P_PSM_CNTXT_3_7_ADDR A:0x6071e80c
y.create.l HWIO_CRYPTO0_CRYPTO_BAM_P_PSM_CNTXT_4_0_ADDR A:0x60717810
y.create.l HWIO_CRYPTO0_CRYPTO_BAM_P_PSM_CNTXT_4_1_ADDR A:0x60718810
y.create.l HWIO_CRYPTO0_CRYPTO_BAM_P_PSM_CNTXT_4_2_ADDR A:0x60719810
y.create.l HWIO_CRYPTO0_CRYPTO_BAM_P_PSM_CNTXT_4_3_ADDR A:0x6071a810
y.create.l HWIO_CRYPTO0_CRYPTO_BAM_P_PSM_CNTXT_4_4_ADDR A:0x6071b810
y.create.l HWIO_CRYPTO0_CRYPTO_BAM_P_PSM_CNTXT_4_5_ADDR A:0x6071c810
y.create.l HWIO_CRYPTO0_CRYPTO_BAM_P_PSM_CNTXT_4_6_ADDR A:0x6071d810
y.create.l HWIO_CRYPTO0_CRYPTO_BAM_P_PSM_CNTXT_4_7_ADDR A:0x6071e810
y.create.l HWIO_CRYPTO0_CRYPTO_BAM_P_PSM_CNTXT_5_0_ADDR A:0x60717814
y.create.l HWIO_CRYPTO0_CRYPTO_BAM_P_PSM_CNTXT_5_1_ADDR A:0x60718814
y.create.l HWIO_CRYPTO0_CRYPTO_BAM_P_PSM_CNTXT_5_2_ADDR A:0x60719814
y.create.l HWIO_CRYPTO0_CRYPTO_BAM_P_PSM_CNTXT_5_3_ADDR A:0x6071a814
y.create.l HWIO_CRYPTO0_CRYPTO_BAM_P_PSM_CNTXT_5_4_ADDR A:0x6071b814
y.create.l HWIO_CRYPTO0_CRYPTO_BAM_P_PSM_CNTXT_5_5_ADDR A:0x6071c814
y.create.l HWIO_CRYPTO0_CRYPTO_BAM_P_PSM_CNTXT_5_6_ADDR A:0x6071d814
y.create.l HWIO_CRYPTO0_CRYPTO_BAM_P_PSM_CNTXT_5_7_ADDR A:0x6071e814
y.create.l HWIO_CRYPTO0_CRYPTO_BAM_P_EVNT_REG0_ADDR A:0x60717818
y.create.l HWIO_CRYPTO0_CRYPTO_BAM_P_EVNT_REG1_ADDR A:0x60718818
y.create.l HWIO_CRYPTO0_CRYPTO_BAM_P_EVNT_REG2_ADDR A:0x60719818
y.create.l HWIO_CRYPTO0_CRYPTO_BAM_P_EVNT_REG3_ADDR A:0x6071a818
y.create.l HWIO_CRYPTO0_CRYPTO_BAM_P_EVNT_REG4_ADDR A:0x6071b818
y.create.l HWIO_CRYPTO0_CRYPTO_BAM_P_EVNT_REG5_ADDR A:0x6071c818
y.create.l HWIO_CRYPTO0_CRYPTO_BAM_P_EVNT_REG6_ADDR A:0x6071d818
y.create.l HWIO_CRYPTO0_CRYPTO_BAM_P_EVNT_REG7_ADDR A:0x6071e818
y.create.l HWIO_CRYPTO0_CRYPTO_BAM_P_DESC_FIFO_ADDR0_ADDR A:0x6071781c
y.create.l HWIO_CRYPTO0_CRYPTO_BAM_P_DESC_FIFO_ADDR1_ADDR A:0x6071881c
y.create.l HWIO_CRYPTO0_CRYPTO_BAM_P_DESC_FIFO_ADDR2_ADDR A:0x6071981c
y.create.l HWIO_CRYPTO0_CRYPTO_BAM_P_DESC_FIFO_ADDR3_ADDR A:0x6071a81c
y.create.l HWIO_CRYPTO0_CRYPTO_BAM_P_DESC_FIFO_ADDR4_ADDR A:0x6071b81c
y.create.l HWIO_CRYPTO0_CRYPTO_BAM_P_DESC_FIFO_ADDR5_ADDR A:0x6071c81c
y.create.l HWIO_CRYPTO0_CRYPTO_BAM_P_DESC_FIFO_ADDR6_ADDR A:0x6071d81c
y.create.l HWIO_CRYPTO0_CRYPTO_BAM_P_DESC_FIFO_ADDR7_ADDR A:0x6071e81c
y.create.l HWIO_CRYPTO0_CRYPTO_BAM_P_FIFO_SIZES0_ADDR A:0x60717820
y.create.l HWIO_CRYPTO0_CRYPTO_BAM_P_FIFO_SIZES1_ADDR A:0x60718820
y.create.l HWIO_CRYPTO0_CRYPTO_BAM_P_FIFO_SIZES2_ADDR A:0x60719820
y.create.l HWIO_CRYPTO0_CRYPTO_BAM_P_FIFO_SIZES3_ADDR A:0x6071a820
y.create.l HWIO_CRYPTO0_CRYPTO_BAM_P_FIFO_SIZES4_ADDR A:0x6071b820
y.create.l HWIO_CRYPTO0_CRYPTO_BAM_P_FIFO_SIZES5_ADDR A:0x6071c820
y.create.l HWIO_CRYPTO0_CRYPTO_BAM_P_FIFO_SIZES6_ADDR A:0x6071d820
y.create.l HWIO_CRYPTO0_CRYPTO_BAM_P_FIFO_SIZES7_ADDR A:0x6071e820
y.create.l HWIO_CRYPTO0_CRYPTO_BAM_P_DATA_FIFO_ADDR0_ADDR A:0x60717824
y.create.l HWIO_CRYPTO0_CRYPTO_BAM_P_DATA_FIFO_ADDR1_ADDR A:0x60718824
y.create.l HWIO_CRYPTO0_CRYPTO_BAM_P_DATA_FIFO_ADDR2_ADDR A:0x60719824
y.create.l HWIO_CRYPTO0_CRYPTO_BAM_P_DATA_FIFO_ADDR3_ADDR A:0x6071a824
y.create.l HWIO_CRYPTO0_CRYPTO_BAM_P_DATA_FIFO_ADDR4_ADDR A:0x6071b824
y.create.l HWIO_CRYPTO0_CRYPTO_BAM_P_DATA_FIFO_ADDR5_ADDR A:0x6071c824
y.create.l HWIO_CRYPTO0_CRYPTO_BAM_P_DATA_FIFO_ADDR6_ADDR A:0x6071d824
y.create.l HWIO_CRYPTO0_CRYPTO_BAM_P_DATA_FIFO_ADDR7_ADDR A:0x6071e824
y.create.l HWIO_CRYPTO0_CRYPTO_BAM_P_EVNT_GEN_TRSHLD0_ADDR A:0x60717828
y.create.l HWIO_CRYPTO0_CRYPTO_BAM_P_EVNT_GEN_TRSHLD1_ADDR A:0x60718828
y.create.l HWIO_CRYPTO0_CRYPTO_BAM_P_EVNT_GEN_TRSHLD2_ADDR A:0x60719828
y.create.l HWIO_CRYPTO0_CRYPTO_BAM_P_EVNT_GEN_TRSHLD3_ADDR A:0x6071a828
y.create.l HWIO_CRYPTO0_CRYPTO_BAM_P_EVNT_GEN_TRSHLD4_ADDR A:0x6071b828
y.create.l HWIO_CRYPTO0_CRYPTO_BAM_P_EVNT_GEN_TRSHLD5_ADDR A:0x6071c828
y.create.l HWIO_CRYPTO0_CRYPTO_BAM_P_EVNT_GEN_TRSHLD6_ADDR A:0x6071d828
y.create.l HWIO_CRYPTO0_CRYPTO_BAM_P_EVNT_GEN_TRSHLD7_ADDR A:0x6071e828
y.create.l HWIO_CRYPTO0_CRYPTO_BAM_P_EVNT_DEST_ADDR0_ADDR A:0x6071782c
y.create.l HWIO_CRYPTO0_CRYPTO_BAM_P_EVNT_DEST_ADDR1_ADDR A:0x6071882c
y.create.l HWIO_CRYPTO0_CRYPTO_BAM_P_EVNT_DEST_ADDR2_ADDR A:0x6071982c
y.create.l HWIO_CRYPTO0_CRYPTO_BAM_P_EVNT_DEST_ADDR3_ADDR A:0x6071a82c
y.create.l HWIO_CRYPTO0_CRYPTO_BAM_P_EVNT_DEST_ADDR4_ADDR A:0x6071b82c
y.create.l HWIO_CRYPTO0_CRYPTO_BAM_P_EVNT_DEST_ADDR5_ADDR A:0x6071c82c
y.create.l HWIO_CRYPTO0_CRYPTO_BAM_P_EVNT_DEST_ADDR6_ADDR A:0x6071d82c
y.create.l HWIO_CRYPTO0_CRYPTO_BAM_P_EVNT_DEST_ADDR7_ADDR A:0x6071e82c
y.create.l HWIO_CRYPTO0_CRYPTO_BAM_P_DF_CNTXT_0_ADDR A:0x60717830
y.create.l HWIO_CRYPTO0_CRYPTO_BAM_P_DF_CNTXT_1_ADDR A:0x60718830
y.create.l HWIO_CRYPTO0_CRYPTO_BAM_P_DF_CNTXT_2_ADDR A:0x60719830
y.create.l HWIO_CRYPTO0_CRYPTO_BAM_P_DF_CNTXT_3_ADDR A:0x6071a830
y.create.l HWIO_CRYPTO0_CRYPTO_BAM_P_DF_CNTXT_4_ADDR A:0x6071b830
y.create.l HWIO_CRYPTO0_CRYPTO_BAM_P_DF_CNTXT_5_ADDR A:0x6071c830
y.create.l HWIO_CRYPTO0_CRYPTO_BAM_P_DF_CNTXT_6_ADDR A:0x6071d830
y.create.l HWIO_CRYPTO0_CRYPTO_BAM_P_DF_CNTXT_7_ADDR A:0x6071e830
y.create.l HWIO_CRYPTO0_CRYPTO_BAM_P_RETR_CNTXT_0_ADDR A:0x60717834
y.create.l HWIO_CRYPTO0_CRYPTO_BAM_P_RETR_CNTXT_1_ADDR A:0x60718834
y.create.l HWIO_CRYPTO0_CRYPTO_BAM_P_RETR_CNTXT_2_ADDR A:0x60719834
y.create.l HWIO_CRYPTO0_CRYPTO_BAM_P_RETR_CNTXT_3_ADDR A:0x6071a834
y.create.l HWIO_CRYPTO0_CRYPTO_BAM_P_RETR_CNTXT_4_ADDR A:0x6071b834
y.create.l HWIO_CRYPTO0_CRYPTO_BAM_P_RETR_CNTXT_5_ADDR A:0x6071c834
y.create.l HWIO_CRYPTO0_CRYPTO_BAM_P_RETR_CNTXT_6_ADDR A:0x6071d834
y.create.l HWIO_CRYPTO0_CRYPTO_BAM_P_RETR_CNTXT_7_ADDR A:0x6071e834
y.create.l HWIO_CRYPTO0_CRYPTO_BAM_P_SI_CNTXT_0_ADDR A:0x60717838
y.create.l HWIO_CRYPTO0_CRYPTO_BAM_P_SI_CNTXT_1_ADDR A:0x60718838
y.create.l HWIO_CRYPTO0_CRYPTO_BAM_P_SI_CNTXT_2_ADDR A:0x60719838
y.create.l HWIO_CRYPTO0_CRYPTO_BAM_P_SI_CNTXT_3_ADDR A:0x6071a838
y.create.l HWIO_CRYPTO0_CRYPTO_BAM_P_SI_CNTXT_4_ADDR A:0x6071b838
y.create.l HWIO_CRYPTO0_CRYPTO_BAM_P_SI_CNTXT_5_ADDR A:0x6071c838
y.create.l HWIO_CRYPTO0_CRYPTO_BAM_P_SI_CNTXT_6_ADDR A:0x6071d838
y.create.l HWIO_CRYPTO0_CRYPTO_BAM_P_SI_CNTXT_7_ADDR A:0x6071e838
y.create.l HWIO_CRYPTO0_CRYPTO_BAM_P_PSM_CNTXT_3_LSB0_ADDR A:0x60717900
y.create.l HWIO_CRYPTO0_CRYPTO_BAM_P_PSM_CNTXT_3_LSB1_ADDR A:0x60718900
y.create.l HWIO_CRYPTO0_CRYPTO_BAM_P_PSM_CNTXT_3_LSB2_ADDR A:0x60719900
y.create.l HWIO_CRYPTO0_CRYPTO_BAM_P_PSM_CNTXT_3_LSB3_ADDR A:0x6071a900
y.create.l HWIO_CRYPTO0_CRYPTO_BAM_P_PSM_CNTXT_3_LSB4_ADDR A:0x6071b900
y.create.l HWIO_CRYPTO0_CRYPTO_BAM_P_PSM_CNTXT_3_LSB5_ADDR A:0x6071c900
y.create.l HWIO_CRYPTO0_CRYPTO_BAM_P_PSM_CNTXT_3_LSB6_ADDR A:0x6071d900
y.create.l HWIO_CRYPTO0_CRYPTO_BAM_P_PSM_CNTXT_3_LSB7_ADDR A:0x6071e900
y.create.l HWIO_CRYPTO0_CRYPTO_BAM_P_PSM_CNTXT_3_MSB0_ADDR A:0x60717904
y.create.l HWIO_CRYPTO0_CRYPTO_BAM_P_PSM_CNTXT_3_MSB1_ADDR A:0x60718904
y.create.l HWIO_CRYPTO0_CRYPTO_BAM_P_PSM_CNTXT_3_MSB2_ADDR A:0x60719904
y.create.l HWIO_CRYPTO0_CRYPTO_BAM_P_PSM_CNTXT_3_MSB3_ADDR A:0x6071a904
y.create.l HWIO_CRYPTO0_CRYPTO_BAM_P_PSM_CNTXT_3_MSB4_ADDR A:0x6071b904
y.create.l HWIO_CRYPTO0_CRYPTO_BAM_P_PSM_CNTXT_3_MSB5_ADDR A:0x6071c904
y.create.l HWIO_CRYPTO0_CRYPTO_BAM_P_PSM_CNTXT_3_MSB6_ADDR A:0x6071d904
y.create.l HWIO_CRYPTO0_CRYPTO_BAM_P_PSM_CNTXT_3_MSB7_ADDR A:0x6071e904
y.create.l HWIO_CRYPTO0_CRYPTO_BAM_P_DESC_FIFO_ADDR_LSB0_ADDR A:0x60717910
y.create.l HWIO_CRYPTO0_CRYPTO_BAM_P_DESC_FIFO_ADDR_LSB1_ADDR A:0x60718910
y.create.l HWIO_CRYPTO0_CRYPTO_BAM_P_DESC_FIFO_ADDR_LSB2_ADDR A:0x60719910
y.create.l HWIO_CRYPTO0_CRYPTO_BAM_P_DESC_FIFO_ADDR_LSB3_ADDR A:0x6071a910
y.create.l HWIO_CRYPTO0_CRYPTO_BAM_P_DESC_FIFO_ADDR_LSB4_ADDR A:0x6071b910
y.create.l HWIO_CRYPTO0_CRYPTO_BAM_P_DESC_FIFO_ADDR_LSB5_ADDR A:0x6071c910
y.create.l HWIO_CRYPTO0_CRYPTO_BAM_P_DESC_FIFO_ADDR_LSB6_ADDR A:0x6071d910
y.create.l HWIO_CRYPTO0_CRYPTO_BAM_P_DESC_FIFO_ADDR_LSB7_ADDR A:0x6071e910
y.create.l HWIO_CRYPTO0_CRYPTO_BAM_P_DESC_FIFO_ADDR_MSB0_ADDR A:0x60717914
y.create.l HWIO_CRYPTO0_CRYPTO_BAM_P_DESC_FIFO_ADDR_MSB1_ADDR A:0x60718914
y.create.l HWIO_CRYPTO0_CRYPTO_BAM_P_DESC_FIFO_ADDR_MSB2_ADDR A:0x60719914
y.create.l HWIO_CRYPTO0_CRYPTO_BAM_P_DESC_FIFO_ADDR_MSB3_ADDR A:0x6071a914
y.create.l HWIO_CRYPTO0_CRYPTO_BAM_P_DESC_FIFO_ADDR_MSB4_ADDR A:0x6071b914
y.create.l HWIO_CRYPTO0_CRYPTO_BAM_P_DESC_FIFO_ADDR_MSB5_ADDR A:0x6071c914
y.create.l HWIO_CRYPTO0_CRYPTO_BAM_P_DESC_FIFO_ADDR_MSB6_ADDR A:0x6071d914
y.create.l HWIO_CRYPTO0_CRYPTO_BAM_P_DESC_FIFO_ADDR_MSB7_ADDR A:0x6071e914
y.create.l HWIO_CRYPTO0_CRYPTO_BAM_P_DATA_FIFO_ADDR_LSB0_ADDR A:0x60717920
y.create.l HWIO_CRYPTO0_CRYPTO_BAM_P_DATA_FIFO_ADDR_LSB1_ADDR A:0x60718920
y.create.l HWIO_CRYPTO0_CRYPTO_BAM_P_DATA_FIFO_ADDR_LSB2_ADDR A:0x60719920
y.create.l HWIO_CRYPTO0_CRYPTO_BAM_P_DATA_FIFO_ADDR_LSB3_ADDR A:0x6071a920
y.create.l HWIO_CRYPTO0_CRYPTO_BAM_P_DATA_FIFO_ADDR_LSB4_ADDR A:0x6071b920
y.create.l HWIO_CRYPTO0_CRYPTO_BAM_P_DATA_FIFO_ADDR_LSB5_ADDR A:0x6071c920
y.create.l HWIO_CRYPTO0_CRYPTO_BAM_P_DATA_FIFO_ADDR_LSB6_ADDR A:0x6071d920
y.create.l HWIO_CRYPTO0_CRYPTO_BAM_P_DATA_FIFO_ADDR_LSB7_ADDR A:0x6071e920
y.create.l HWIO_CRYPTO0_CRYPTO_BAM_P_DATA_FIFO_ADDR_MSB0_ADDR A:0x60717924
y.create.l HWIO_CRYPTO0_CRYPTO_BAM_P_DATA_FIFO_ADDR_MSB1_ADDR A:0x60718924
y.create.l HWIO_CRYPTO0_CRYPTO_BAM_P_DATA_FIFO_ADDR_MSB2_ADDR A:0x60719924
y.create.l HWIO_CRYPTO0_CRYPTO_BAM_P_DATA_FIFO_ADDR_MSB3_ADDR A:0x6071a924
y.create.l HWIO_CRYPTO0_CRYPTO_BAM_P_DATA_FIFO_ADDR_MSB4_ADDR A:0x6071b924
y.create.l HWIO_CRYPTO0_CRYPTO_BAM_P_DATA_FIFO_ADDR_MSB5_ADDR A:0x6071c924
y.create.l HWIO_CRYPTO0_CRYPTO_BAM_P_DATA_FIFO_ADDR_MSB6_ADDR A:0x6071d924
y.create.l HWIO_CRYPTO0_CRYPTO_BAM_P_DATA_FIFO_ADDR_MSB7_ADDR A:0x6071e924
y.create.l HWIO_CRYPTO0_CRYPTO_BAM_P_EVNT_DEST_ADDR_LSB0_ADDR A:0x60717930
y.create.l HWIO_CRYPTO0_CRYPTO_BAM_P_EVNT_DEST_ADDR_LSB1_ADDR A:0x60718930
y.create.l HWIO_CRYPTO0_CRYPTO_BAM_P_EVNT_DEST_ADDR_LSB2_ADDR A:0x60719930
y.create.l HWIO_CRYPTO0_CRYPTO_BAM_P_EVNT_DEST_ADDR_LSB3_ADDR A:0x6071a930
y.create.l HWIO_CRYPTO0_CRYPTO_BAM_P_EVNT_DEST_ADDR_LSB4_ADDR A:0x6071b930
y.create.l HWIO_CRYPTO0_CRYPTO_BAM_P_EVNT_DEST_ADDR_LSB5_ADDR A:0x6071c930
y.create.l HWIO_CRYPTO0_CRYPTO_BAM_P_EVNT_DEST_ADDR_LSB6_ADDR A:0x6071d930
y.create.l HWIO_CRYPTO0_CRYPTO_BAM_P_EVNT_DEST_ADDR_LSB7_ADDR A:0x6071e930
y.create.l HWIO_CRYPTO0_CRYPTO_BAM_P_EVNT_DEST_ADDR_MSB0_ADDR A:0x60717934
y.create.l HWIO_CRYPTO0_CRYPTO_BAM_P_EVNT_DEST_ADDR_MSB1_ADDR A:0x60718934
y.create.l HWIO_CRYPTO0_CRYPTO_BAM_P_EVNT_DEST_ADDR_MSB2_ADDR A:0x60719934
y.create.l HWIO_CRYPTO0_CRYPTO_BAM_P_EVNT_DEST_ADDR_MSB3_ADDR A:0x6071a934
y.create.l HWIO_CRYPTO0_CRYPTO_BAM_P_EVNT_DEST_ADDR_MSB4_ADDR A:0x6071b934
y.create.l HWIO_CRYPTO0_CRYPTO_BAM_P_EVNT_DEST_ADDR_MSB5_ADDR A:0x6071c934
y.create.l HWIO_CRYPTO0_CRYPTO_BAM_P_EVNT_DEST_ADDR_MSB6_ADDR A:0x6071d934
y.create.l HWIO_CRYPTO0_CRYPTO_BAM_P_EVNT_DEST_ADDR_MSB7_ADDR A:0x6071e934
y.create.l HWIO_CRYPTO0_CRYPTO_BAM_XPU_SCR_ADDR A:0x60702000
y.create.l HWIO_CRYPTO0_CRYPTO_BAM_XPU_SWDR_ADDR A:0x60702004
y.create.l HWIO_CRYPTO0_CRYPTO_BAM_XPU_SEAR0_ADDR A:0x60702040
y.create.l HWIO_CRYPTO0_CRYPTO_BAM_XPU_SESR_ADDR A:0x60702048
y.create.l HWIO_CRYPTO0_CRYPTO_BAM_XPU_SESRRESTORE_ADDR A:0x6070204c
y.create.l HWIO_CRYPTO0_CRYPTO_BAM_XPU_SESYNR0_ADDR A:0x60702050
y.create.l HWIO_CRYPTO0_CRYPTO_BAM_XPU_SESYNR1_ADDR A:0x60702054
y.create.l HWIO_CRYPTO0_CRYPTO_BAM_XPU_SESYNR2_ADDR A:0x60702058
y.create.l HWIO_CRYPTO0_CRYPTO_BAM_XPU_MCR_ADDR A:0x60702100
y.create.l HWIO_CRYPTO0_CRYPTO_BAM_XPU_MEAR0_ADDR A:0x60702140
y.create.l HWIO_CRYPTO0_CRYPTO_BAM_XPU_MESR_ADDR A:0x60702148
y.create.l HWIO_CRYPTO0_CRYPTO_BAM_XPU_MESRRESTORE_ADDR A:0x6070214c
y.create.l HWIO_CRYPTO0_CRYPTO_BAM_XPU_MESYNR0_ADDR A:0x60702150
y.create.l HWIO_CRYPTO0_CRYPTO_BAM_XPU_MESYNR1_ADDR A:0x60702154
y.create.l HWIO_CRYPTO0_CRYPTO_BAM_XPU_MESYNR2_ADDR A:0x60702158
y.create.l HWIO_CRYPTO0_CRYPTO_BAM_XPU_CR_ADDR A:0x60702080
y.create.l HWIO_CRYPTO0_CRYPTO_BAM_XPU_RPU_ACR0_ADDR A:0x607020a0
y.create.l HWIO_CRYPTO0_CRYPTO_BAM_XPU_EAR0_ADDR A:0x607020c0
y.create.l HWIO_CRYPTO0_CRYPTO_BAM_XPU_ESR_ADDR A:0x607020c8
y.create.l HWIO_CRYPTO0_CRYPTO_BAM_XPU_ESRRESTORE_ADDR A:0x607020cc
y.create.l HWIO_CRYPTO0_CRYPTO_BAM_XPU_ESYNR0_ADDR A:0x607020d0
y.create.l HWIO_CRYPTO0_CRYPTO_BAM_XPU_ESYNR1_ADDR A:0x607020d4
y.create.l HWIO_CRYPTO0_CRYPTO_BAM_XPU_ESYNR2_ADDR A:0x607020d8
y.create.l HWIO_CRYPTO0_CRYPTO_BAM_XPU_IDR0_ADDR A:0x60702074
y.create.l HWIO_CRYPTO0_CRYPTO_BAM_XPU_IDR1_ADDR A:0x60702078
y.create.l HWIO_CRYPTO0_CRYPTO_BAM_XPU_REV_ADDR A:0x6070207c
y.create.l HWIO_CRYPTO0_CRYPTO_BAM_XPU_RG0_RACR0_ADDR A:0x60702200
y.create.l HWIO_CRYPTO0_CRYPTO_BAM_XPU_RG1_RACR0_ADDR A:0x60702280
y.create.l HWIO_CRYPTO0_CRYPTO_BAM_XPU_RG2_RACR0_ADDR A:0x60702300
y.create.l HWIO_CRYPTO0_CRYPTO_BAM_XPU_RG3_RACR0_ADDR A:0x60702380
y.create.l HWIO_CRYPTO0_CRYPTO_BAM_XPU_RG4_RACR0_ADDR A:0x60702400
y.create.l HWIO_CRYPTO0_CRYPTO_BAM_XPU_RG5_RACR0_ADDR A:0x60702480
y.create.l HWIO_CRYPTO0_CRYPTO_BAM_XPU_RG6_RACR0_ADDR A:0x60702500
y.create.l HWIO_CRYPTO0_CRYPTO_BAM_XPU_RG7_RACR0_ADDR A:0x60702580
y.create.l HWIO_CRYPTO0_CRYPTO_BAM_XPU_RG8_RACR0_ADDR A:0x60702600
y.create.l HWIO_CRYPTO0_CRYPTO_BAM_XPU_RG9_RACR0_ADDR A:0x60702680
y.create.l HWIO_CRYPTO0_CRYPTO_BAM_XPU_RG0_SCR_ADDR A:0x60702250
y.create.l HWIO_CRYPTO0_CRYPTO_BAM_XPU_RG1_SCR_ADDR A:0x607022d0
y.create.l HWIO_CRYPTO0_CRYPTO_BAM_XPU_RG2_SCR_ADDR A:0x60702350
y.create.l HWIO_CRYPTO0_CRYPTO_BAM_XPU_RG3_SCR_ADDR A:0x607023d0
y.create.l HWIO_CRYPTO0_CRYPTO_BAM_XPU_RG4_SCR_ADDR A:0x60702450
y.create.l HWIO_CRYPTO0_CRYPTO_BAM_XPU_RG5_SCR_ADDR A:0x607024d0
y.create.l HWIO_CRYPTO0_CRYPTO_BAM_XPU_RG6_SCR_ADDR A:0x60702550
y.create.l HWIO_CRYPTO0_CRYPTO_BAM_XPU_RG7_SCR_ADDR A:0x607025d0
y.create.l HWIO_CRYPTO0_CRYPTO_BAM_XPU_RG8_SCR_ADDR A:0x60702650
y.create.l HWIO_CRYPTO0_CRYPTO_BAM_XPU_RG9_SCR_ADDR A:0x607026d0
y.create.l HWIO_CRYPTO0_CRYPTO_BAM_XPU_RG0_MCR_ADDR A:0x60702254
y.create.l HWIO_CRYPTO0_CRYPTO_BAM_XPU_RG1_MCR_ADDR A:0x607022d4
y.create.l HWIO_CRYPTO0_CRYPTO_BAM_XPU_RG2_MCR_ADDR A:0x60702354
y.create.l HWIO_CRYPTO0_CRYPTO_BAM_XPU_RG3_MCR_ADDR A:0x607023d4
y.create.l HWIO_CRYPTO0_CRYPTO_BAM_XPU_RG4_MCR_ADDR A:0x60702454
y.create.l HWIO_CRYPTO0_CRYPTO_BAM_XPU_RG5_MCR_ADDR A:0x607024d4
y.create.l HWIO_CRYPTO0_CRYPTO_BAM_XPU_RG6_MCR_ADDR A:0x60702554
y.create.l HWIO_CRYPTO0_CRYPTO_BAM_XPU_RG7_MCR_ADDR A:0x607025d4
y.create.l HWIO_CRYPTO0_CRYPTO_BAM_XPU_RG8_MCR_ADDR A:0x60702654
y.create.l HWIO_CRYPTO0_CRYPTO_BAM_XPU_RG9_MCR_ADDR A:0x607026d4
y.create.l HWIO_CRYPTO0_CRYPTO_BAM_VMIDMT_SCR0_ADDR A:0x60700000
y.create.l HWIO_CRYPTO0_CRYPTO_BAM_VMIDMT_SCR1_ADDR A:0x60700004
y.create.l HWIO_CRYPTO0_CRYPTO_BAM_VMIDMT_SCR2_ADDR A:0x60700008
y.create.l HWIO_CRYPTO0_CRYPTO_BAM_VMIDMT_SACR_ADDR A:0x60700010
y.create.l HWIO_CRYPTO0_CRYPTO_BAM_VMIDMT_SIDR0_ADDR A:0x60700020
y.create.l HWIO_CRYPTO0_CRYPTO_BAM_VMIDMT_SIDR1_ADDR A:0x60700024
y.create.l HWIO_CRYPTO0_CRYPTO_BAM_VMIDMT_SIDR2_ADDR A:0x60700028
y.create.l HWIO_CRYPTO0_CRYPTO_BAM_VMIDMT_SIDR4_ADDR A:0x60700030
y.create.l HWIO_CRYPTO0_CRYPTO_BAM_VMIDMT_SIDR5_ADDR A:0x60700034
y.create.l HWIO_CRYPTO0_CRYPTO_BAM_VMIDMT_SIDR7_ADDR A:0x6070003c
y.create.l HWIO_CRYPTO0_CRYPTO_BAM_VMIDMT_SGFAR0_ADDR A:0x60700040
y.create.l HWIO_CRYPTO0_CRYPTO_BAM_VMIDMT_SGFSR_ADDR A:0x60700048
y.create.l HWIO_CRYPTO0_CRYPTO_BAM_VMIDMT_SGFSRRESTORE_ADDR A:0x6070004c
y.create.l HWIO_CRYPTO0_CRYPTO_BAM_VMIDMT_SGFSYNDR0_ADDR A:0x60700050
y.create.l HWIO_CRYPTO0_CRYPTO_BAM_VMIDMT_SGFSYNDR1_ADDR A:0x60700054
y.create.l HWIO_CRYPTO0_CRYPTO_BAM_VMIDMT_SGFSYNDR2_ADDR A:0x60700058
y.create.l HWIO_CRYPTO0_CRYPTO_BAM_VMIDMT_VMIDMTSCR0_ADDR A:0x60700090
y.create.l HWIO_CRYPTO0_CRYPTO_BAM_VMIDMT_CR0_ADDR A:0x60700000
y.create.l HWIO_CRYPTO0_CRYPTO_BAM_VMIDMT_CR2_ADDR A:0x60700008
y.create.l HWIO_CRYPTO0_CRYPTO_BAM_VMIDMT_ACR_ADDR A:0x60700010
y.create.l HWIO_CRYPTO0_CRYPTO_BAM_VMIDMT_IDR0_ADDR A:0x60700020
y.create.l HWIO_CRYPTO0_CRYPTO_BAM_VMIDMT_IDR1_ADDR A:0x60700024
y.create.l HWIO_CRYPTO0_CRYPTO_BAM_VMIDMT_IDR2_ADDR A:0x60700028
y.create.l HWIO_CRYPTO0_CRYPTO_BAM_VMIDMT_IDR4_ADDR A:0x60700030
y.create.l HWIO_CRYPTO0_CRYPTO_BAM_VMIDMT_IDR5_ADDR A:0x60700034
y.create.l HWIO_CRYPTO0_CRYPTO_BAM_VMIDMT_IDR7_ADDR A:0x6070003c
y.create.l HWIO_CRYPTO0_CRYPTO_BAM_VMIDMT_GFAR0_ADDR A:0x60700040
y.create.l HWIO_CRYPTO0_CRYPTO_BAM_VMIDMT_GFSR_ADDR A:0x60700048
y.create.l HWIO_CRYPTO0_CRYPTO_BAM_VMIDMT_GFSRRESTORE_ADDR A:0x6070004c
y.create.l HWIO_CRYPTO0_CRYPTO_BAM_VMIDMT_GFSYNDR0_ADDR A:0x60700050
y.create.l HWIO_CRYPTO0_CRYPTO_BAM_VMIDMT_GFSYNDR1_ADDR A:0x60700054
y.create.l HWIO_CRYPTO0_CRYPTO_BAM_VMIDMT_GFSYNDR2_ADDR A:0x60700058
y.create.l HWIO_CRYPTO0_CRYPTO_BAM_VMIDMT_VMIDMTCR0_ADDR A:0x60700090
y.create.l HWIO_CRYPTO0_CRYPTO_BAM_VMIDMT_VMIDMTACR_ADDR A:0x6070009c
y.create.l HWIO_CRYPTO0_CRYPTO_BAM_VMIDMT_NSCR0_ADDR A:0x60700400
y.create.l HWIO_CRYPTO0_CRYPTO_BAM_VMIDMT_NSCR2_ADDR A:0x60700408
y.create.l HWIO_CRYPTO0_CRYPTO_BAM_VMIDMT_NSACR_ADDR A:0x60700410
y.create.l HWIO_CRYPTO0_CRYPTO_BAM_VMIDMT_NSGFAR0_ADDR A:0x60700440
y.create.l HWIO_CRYPTO0_CRYPTO_BAM_VMIDMT_NSGFSR_ADDR A:0x60700448
y.create.l HWIO_CRYPTO0_CRYPTO_BAM_VMIDMT_NSGFSRRESTORE_ADDR A:0x6070044c
y.create.l HWIO_CRYPTO0_CRYPTO_BAM_VMIDMT_NSGFSYNDR0_ADDR A:0x60700450
y.create.l HWIO_CRYPTO0_CRYPTO_BAM_VMIDMT_NSGFSYNDR1_ADDR A:0x60700454
y.create.l HWIO_CRYPTO0_CRYPTO_BAM_VMIDMT_NSGFSYNDR2_ADDR A:0x60700458
y.create.l HWIO_CRYPTO0_CRYPTO_BAM_VMIDMT_NSVMIDMTCR0_ADDR A:0x60700490
y.create.l HWIO_CRYPTO0_CRYPTO_BAM_VMIDMT_SSDR0_ADDR A:0x60700080
y.create.l HWIO_CRYPTO0_CRYPTO_BAM_VMIDMT_MSDR0_ADDR A:0x60700480
y.create.l HWIO_CRYPTO0_CRYPTO_BAM_VMIDMT_MCR_ADDR A:0x60700494
y.create.l HWIO_CRYPTO0_CRYPTO_BAM_VMIDMT_S2VR0_ADDR A:0x60700c00
y.create.l HWIO_CRYPTO0_CRYPTO_BAM_VMIDMT_S2VR1_ADDR A:0x60700c04
y.create.l HWIO_CRYPTO0_CRYPTO_BAM_VMIDMT_S2VR2_ADDR A:0x60700c08
y.create.l HWIO_CRYPTO0_CRYPTO_BAM_VMIDMT_S2VR3_ADDR A:0x60700c0c
y.create.l HWIO_CRYPTO0_CRYPTO_BAM_VMIDMT_S2VR4_ADDR A:0x60700c10
y.create.l HWIO_CRYPTO0_CRYPTO_BAM_VMIDMT_S2VR5_ADDR A:0x60700c14
y.create.l HWIO_CRYPTO0_CRYPTO_BAM_VMIDMT_S2VR6_ADDR A:0x60700c18
y.create.l HWIO_CRYPTO0_CRYPTO_BAM_VMIDMT_S2VR7_ADDR A:0x60700c1c
y.create.l HWIO_CRYPTO0_CRYPTO_BAM_VMIDMT_S2VR8_ADDR A:0x60700c20
y.create.l HWIO_CRYPTO0_CRYPTO_BAM_VMIDMT_AS2VR0_ADDR A:0x60700e00
y.create.l HWIO_CRYPTO0_CRYPTO_BAM_VMIDMT_AS2VR1_ADDR A:0x60700e04
y.create.l HWIO_CRYPTO0_CRYPTO_BAM_VMIDMT_AS2VR2_ADDR A:0x60700e08
y.create.l HWIO_CRYPTO0_CRYPTO_BAM_VMIDMT_AS2VR3_ADDR A:0x60700e0c
y.create.l HWIO_CRYPTO0_CRYPTO_BAM_VMIDMT_AS2VR4_ADDR A:0x60700e10
y.create.l HWIO_CRYPTO0_CRYPTO_BAM_VMIDMT_AS2VR5_ADDR A:0x60700e14
y.create.l HWIO_CRYPTO0_CRYPTO_BAM_VMIDMT_AS2VR6_ADDR A:0x60700e18
y.create.l HWIO_CRYPTO0_CRYPTO_BAM_VMIDMT_AS2VR7_ADDR A:0x60700e1c
y.create.l HWIO_CRYPTO0_CRYPTO_BAM_VMIDMT_AS2VR8_ADDR A:0x60700e20
y.create.l HWIO_CRYPTO0_CRYPTO_BAM_VMIDMT_SMR0_ADDR A:0x60700800
y.create.l HWIO_CRYPTO0_CRYPTO_BAM_VMIDMT_SMR1_ADDR A:0x60700804
y.create.l HWIO_CRYPTO0_CRYPTO_BAM_VMIDMT_SMR2_ADDR A:0x60700808
y.create.l HWIO_CRYPTO0_CRYPTO_BAM_VMIDMT_SMR3_ADDR A:0x6070080c
y.create.l HWIO_CRYPTO0_CRYPTO_BAM_VMIDMT_SMR4_ADDR A:0x60700810
y.create.l HWIO_CRYPTO0_CRYPTO_BAM_VMIDMT_SMR5_ADDR A:0x60700814
y.create.l HWIO_CRYPTO0_CRYPTO_BAM_VMIDMT_SMR6_ADDR A:0x60700818
y.create.l HWIO_CRYPTO0_CRYPTO_BAM_VMIDMT_SMR7_ADDR A:0x6070081c
y.create.l HWIO_CRYPTO0_CRYPTO_BAM_VMIDMT_SMR8_ADDR A:0x60700820
y.create.l HWIO_DEHR_BIMC_DEHR_HW_VERSION_ADDR A:0x604b2000
y.create.l HWIO_DEHR_BIMC_DEHR_HW_INFO_ADDR A:0x604b2004
y.create.l HWIO_DEHR_BIMC_DEHR_CGC_CFG_ADDR A:0x604b2010
y.create.l HWIO_DEHR_BIMC_DEHR_MSA_CFG_ADDR A:0x604b2104
y.create.l HWIO_DEHR_BIMC_DEHR_RAM_CFG_ADDR A:0x604b2140
y.create.l HWIO_DEHR_BIMC_DEHR_DMA_STATUS_ADDR A:0x604b2200
y.create.l HWIO_DEHR_BIMC_DEHR_DBG_CFG_ADDR A:0x604b2400
y.create.l HWIO_DEHR_BIMC_DEHR_SW_DMA_CFG_ADDR A:0x604b2404
y.create.l HWIO_DEHR_BIMC_DEHR_DBG_ADDR_ADDR A:0x604b2408
y.create.l HWIO_DEHR_BIMC_DEHR_SEC_CFG_ADDR A:0x604b3000
y.create.l HWIO_DEHR_XPU_SCR_ADDR A:0x604b0000
y.create.l HWIO_DEHR_XPU_SWDR_ADDR A:0x604b0004
y.create.l HWIO_DEHR_XPU_SEAR0_ADDR A:0x604b0040
y.create.l HWIO_DEHR_XPU_SESR_ADDR A:0x604b0048
y.create.l HWIO_DEHR_XPU_SESRRESTORE_ADDR A:0x604b004c
y.create.l HWIO_DEHR_XPU_SESYNR0_ADDR A:0x604b0050
y.create.l HWIO_DEHR_XPU_SESYNR1_ADDR A:0x604b0054
y.create.l HWIO_DEHR_XPU_SESYNR2_ADDR A:0x604b0058
y.create.l HWIO_DEHR_XPU_MCR_ADDR A:0x604b0100
y.create.l HWIO_DEHR_XPU_MEAR0_ADDR A:0x604b0140
y.create.l HWIO_DEHR_XPU_MESR_ADDR A:0x604b0148
y.create.l HWIO_DEHR_XPU_MESRRESTORE_ADDR A:0x604b014c
y.create.l HWIO_DEHR_XPU_MESYNR0_ADDR A:0x604b0150
y.create.l HWIO_DEHR_XPU_MESYNR1_ADDR A:0x604b0154
y.create.l HWIO_DEHR_XPU_MESYNR2_ADDR A:0x604b0158
y.create.l HWIO_DEHR_XPU_CR_ADDR A:0x604b0080
y.create.l HWIO_DEHR_XPU_RPU_ACR0_ADDR A:0x604b00a0
y.create.l HWIO_DEHR_XPU_EAR0_ADDR A:0x604b00c0
y.create.l HWIO_DEHR_XPU_ESR_ADDR A:0x604b00c8
y.create.l HWIO_DEHR_XPU_ESRRESTORE_ADDR A:0x604b00cc
y.create.l HWIO_DEHR_XPU_ESYNR0_ADDR A:0x604b00d0
y.create.l HWIO_DEHR_XPU_ESYNR1_ADDR A:0x604b00d4
y.create.l HWIO_DEHR_XPU_ESYNR2_ADDR A:0x604b00d8
y.create.l HWIO_DEHR_XPU_IDR0_ADDR A:0x604b0074
y.create.l HWIO_DEHR_XPU_IDR1_ADDR A:0x604b0078
y.create.l HWIO_DEHR_XPU_REV_ADDR A:0x604b007c
y.create.l HWIO_DEHR_XPU_RG0_RACR0_ADDR A:0x604b0200
y.create.l HWIO_DEHR_XPU_RG1_RACR0_ADDR A:0x604b0280
y.create.l HWIO_DEHR_XPU_RG0_SCR_ADDR A:0x604b0250
y.create.l HWIO_DEHR_XPU_RG1_SCR_ADDR A:0x604b02d0
y.create.l HWIO_DEHR_XPU_RG0_MCR_ADDR A:0x604b0254
y.create.l HWIO_DEHR_XPU_RG1_MCR_ADDR A:0x604b02d4
y.create.l HWIO_DEHR_VMIDMT_SCR0_ADDR A:0x604b1000
y.create.l HWIO_DEHR_VMIDMT_SCR1_ADDR A:0x604b1004
y.create.l HWIO_DEHR_VMIDMT_SCR2_ADDR A:0x604b1008
y.create.l HWIO_DEHR_VMIDMT_SACR_ADDR A:0x604b1010
y.create.l HWIO_DEHR_VMIDMT_SIDR0_ADDR A:0x604b1020
y.create.l HWIO_DEHR_VMIDMT_SIDR1_ADDR A:0x604b1024
y.create.l HWIO_DEHR_VMIDMT_SIDR2_ADDR A:0x604b1028
y.create.l HWIO_DEHR_VMIDMT_SIDR4_ADDR A:0x604b1030
y.create.l HWIO_DEHR_VMIDMT_SIDR5_ADDR A:0x604b1034
y.create.l HWIO_DEHR_VMIDMT_SIDR7_ADDR A:0x604b103c
y.create.l HWIO_DEHR_VMIDMT_SGFAR0_ADDR A:0x604b1040
y.create.l HWIO_DEHR_VMIDMT_SGFSR_ADDR A:0x604b1048
y.create.l HWIO_DEHR_VMIDMT_SGFSRRESTORE_ADDR A:0x604b104c
y.create.l HWIO_DEHR_VMIDMT_SGFSYNDR0_ADDR A:0x604b1050
y.create.l HWIO_DEHR_VMIDMT_SGFSYNDR1_ADDR A:0x604b1054
y.create.l HWIO_DEHR_VMIDMT_SGFSYNDR2_ADDR A:0x604b1058
y.create.l HWIO_DEHR_VMIDMT_VMIDMTSCR0_ADDR A:0x604b1090
y.create.l HWIO_DEHR_VMIDMT_CR0_ADDR A:0x604b1000
y.create.l HWIO_DEHR_VMIDMT_CR2_ADDR A:0x604b1008
y.create.l HWIO_DEHR_VMIDMT_ACR_ADDR A:0x604b1010
y.create.l HWIO_DEHR_VMIDMT_IDR0_ADDR A:0x604b1020
y.create.l HWIO_DEHR_VMIDMT_IDR1_ADDR A:0x604b1024
y.create.l HWIO_DEHR_VMIDMT_IDR2_ADDR A:0x604b1028
y.create.l HWIO_DEHR_VMIDMT_IDR4_ADDR A:0x604b1030
y.create.l HWIO_DEHR_VMIDMT_IDR5_ADDR A:0x604b1034
y.create.l HWIO_DEHR_VMIDMT_IDR7_ADDR A:0x604b103c
y.create.l HWIO_DEHR_VMIDMT_GFAR0_ADDR A:0x604b1040
y.create.l HWIO_DEHR_VMIDMT_GFSR_ADDR A:0x604b1048
y.create.l HWIO_DEHR_VMIDMT_GFSRRESTORE_ADDR A:0x604b104c
y.create.l HWIO_DEHR_VMIDMT_GFSYNDR0_ADDR A:0x604b1050
y.create.l HWIO_DEHR_VMIDMT_GFSYNDR1_ADDR A:0x604b1054
y.create.l HWIO_DEHR_VMIDMT_GFSYNDR2_ADDR A:0x604b1058
y.create.l HWIO_DEHR_VMIDMT_VMIDMTCR0_ADDR A:0x604b1090
y.create.l HWIO_DEHR_VMIDMT_VMIDMTACR_ADDR A:0x604b109c
y.create.l HWIO_DEHR_VMIDMT_NSCR0_ADDR A:0x604b1400
y.create.l HWIO_DEHR_VMIDMT_NSCR2_ADDR A:0x604b1408
y.create.l HWIO_DEHR_VMIDMT_NSACR_ADDR A:0x604b1410
y.create.l HWIO_DEHR_VMIDMT_NSGFAR0_ADDR A:0x604b1440
y.create.l HWIO_DEHR_VMIDMT_NSGFSR_ADDR A:0x604b1448
y.create.l HWIO_DEHR_VMIDMT_NSGFSRRESTORE_ADDR A:0x604b144c
y.create.l HWIO_DEHR_VMIDMT_NSGFSYNDR0_ADDR A:0x604b1450
y.create.l HWIO_DEHR_VMIDMT_NSGFSYNDR1_ADDR A:0x604b1454
y.create.l HWIO_DEHR_VMIDMT_NSGFSYNDR2_ADDR A:0x604b1458
y.create.l HWIO_DEHR_VMIDMT_NSVMIDMTCR0_ADDR A:0x604b1490
y.create.l HWIO_DEHR_VMIDMT_SSDR0_ADDR A:0x604b1080
y.create.l HWIO_DEHR_VMIDMT_MSDR0_ADDR A:0x604b1480
y.create.l HWIO_DEHR_VMIDMT_MCR_ADDR A:0x604b1494
y.create.l HWIO_DEHR_VMIDMT_S2VR0_ADDR A:0x604b1c00
y.create.l HWIO_DEHR_VMIDMT_AS2VR0_ADDR A:0x604b1e00
y.create.l HWIO_DIM_C00_DIM_CA_TOP_CFG_ADDR A:0x60480000
y.create.l HWIO_DIM_C00_DIM_CA_HW_INFO_ADDR A:0x60480004
y.create.l HWIO_DIM_C00_DIM_CA_HW_VERSION_ADDR A:0x60480008
y.create.l HWIO_DIM_C00_DIM_CA_PAD_CFG0_ADDR A:0x60480010
y.create.l HWIO_DIM_C00_DIM_CA_PAD_CFG1_ADDR A:0x60480014
y.create.l HWIO_DIM_C00_DIM_CA_PAD_CFG2_ADDR A:0x60480018
y.create.l HWIO_DIM_C00_DIM_CA_PAD_CFG3_ADDR A:0x6048001c
y.create.l HWIO_DIM_C00_DIM_CA_PAD_CFG4_ADDR A:0x60480020
y.create.l HWIO_DIM_C00_DDRPHY_CA_MISR_CFG_ADDR A:0x60480024
y.create.l HWIO_DIM_C00_DDRPHY_CA_MISR_EVEN_STATUS_ADDR A:0x60480028
y.create.l HWIO_DIM_C00_DDRPHY_CA_MISR_ODD_STATUS_ADDR A:0x6048002c
y.create.l HWIO_DIM_C00_DIM_CA_CDC_CTLR_CFG0_ADDR A:0x60480030
y.create.l HWIO_DIM_C00_DIM_CA_CDC_CTLR_CFG1_ADDR A:0x60480034
y.create.l HWIO_DIM_C00_DIM_CA_CDC_CAL_TIMER_CFG0_ADDR A:0x60480038
y.create.l HWIO_DIM_C00_DIM_CA_CDC_CAL_TIMER_CFG1_ADDR A:0x6048003c
y.create.l HWIO_DIM_C00_DIM_CA_CDC_REFCOUNT_CFG_ADDR A:0x60480040
y.create.l HWIO_DIM_C00_DIM_CA_CDC_COARSE_CAL_CFG_ADDR A:0x60480044
y.create.l HWIO_DIM_C00_DIM_CA_CDC_RSVD_CFG_ADDR A:0x60480048
y.create.l HWIO_DIM_C00_DIM_CA_CDC_OFFSET_CFG_ADDR A:0x6048004c
y.create.l HWIO_DIM_C00_DIM_CA_CDC_DELAY_CFG_ADDR A:0x60480050
y.create.l HWIO_DIM_C00_DIM_CA_CDC_SW_MODE_CFG_ADDR A:0x60480054
y.create.l HWIO_DIM_C00_DIM_CA_CDC_TEST_CFG_ADDR A:0x60480058
y.create.l HWIO_DIM_C00_DIM_CA_CDC_SW_OVRD_CFG_ADDR A:0x6048005c
y.create.l HWIO_DIM_C00_DIM_CA_CDC_STATUS0_ADDR A:0x60480070
y.create.l HWIO_DIM_C00_DIM_CA_CDC_STATUS1_ADDR A:0x60480074
y.create.l HWIO_DIM_C00_DIM_CA_CDC_STATUS2_ADDR A:0x60480078
y.create.l HWIO_DIM_C00_DIM_CA_CDC_STATUS3_ADDR A:0x6048007c
y.create.l HWIO_DIM_C00_DIM_CA_IOC_CTLR_CFG_ADDR A:0x604800e0
y.create.l HWIO_DIM_C00_DIM_CA_IOC_CTLR_PNCNT_CFG_ADDR A:0x604800e4
y.create.l HWIO_DIM_C00_DIM_CA_IOC_CTLR_TIMER_CFG_ADDR A:0x604800e8
y.create.l HWIO_DIM_C00_DIM_CA_IOC_CTLR_TIMER_STATUS_ADDR A:0x604800ec
y.create.l HWIO_DIM_C00_DIM_CA_IOC_CTLR_CHAR_CFG_ADDR A:0x604800f0
y.create.l HWIO_DIM_C00_DIM_CA_IOC_CTLR_STATUS_ADDR A:0x604800f4
y.create.l HWIO_DIM_C00_DIM_CA_CA_IOC_SLV_CFG_ADDR A:0x60480100
y.create.l HWIO_DIM_C00_DIM_CA_CA_IOC_SLV_STATUS_ADDR A:0x60480104
y.create.l HWIO_DIM_C00_DIM_CA_CK_IOC_SLV_CFG_ADDR A:0x60480110
y.create.l HWIO_DIM_C00_DIM_CA_CK_IOC_SLV_STATUS_ADDR A:0x60480114
y.create.l HWIO_DIM_D00_DIM_DQ_TOP_CFG_ADDR A:0x60480800
y.create.l HWIO_DIM_D00_DIM_DQ_HW_INFO_ADDR A:0x60480804
y.create.l HWIO_DIM_D00_DIM_DQ_HW_VERSION_ADDR A:0x60480808
y.create.l HWIO_DIM_D00_DIM_DQ_PAD_CFG0_ADDR A:0x60480810
y.create.l HWIO_DIM_D00_DIM_DQ_PAD_CFG1_ADDR A:0x60480814
y.create.l HWIO_DIM_D00_DIM_DQ_PAD_CFG2_ADDR A:0x60480818
y.create.l HWIO_DIM_D00_DIM_DQ_DQ_SMT_STATUS_ADDR A:0x6048081c
y.create.l HWIO_DIM_D00_DIM_DQ_PAD_CFG3_ADDR A:0x60480820
y.create.l HWIO_DIM_D00_DDRPHY_DQ_MISR_CFG_ADDR A:0x6048080c
y.create.l HWIO_DIM_D00_DDRPHY_DQ_MISR_EVEN_STATUS_ADDR A:0x60480828
y.create.l HWIO_DIM_D00_DDRPHY_DQ_MISR_ODD_STATUS_ADDR A:0x6048082c
y.create.l HWIO_DIM_D00_DIM_DQ_CDC_CTLR_CFG0_ADDR A:0x60480830
y.create.l HWIO_DIM_D00_DIM_DQ_CDC_CTLR_CFG1_ADDR A:0x60480834
y.create.l HWIO_DIM_D00_DIM_DQ_CDC_CAL_TIMER_CFG0_ADDR A:0x60480838
y.create.l HWIO_DIM_D00_DIM_DQ_CDC_CAL_TIMER_CFG1_ADDR A:0x6048083c
y.create.l HWIO_DIM_D00_DIM_DQ_CDC_REFCOUNT_CFG_ADDR A:0x60480840
y.create.l HWIO_DIM_D00_DIM_DQ_CDC_COARSE_CAL_CFG_ADDR A:0x60480844
y.create.l HWIO_DIM_D00_DIM_DQ_CDC_RSVD_CFG_ADDR A:0x60480848
y.create.l HWIO_DIM_D00_DIM_DQ_RD_CDC_OFFSET_CFG_ADDR A:0x6048084c
y.create.l HWIO_DIM_D00_DIM_DQ_RD_CDC_DELAY_CFG_ADDR A:0x60480850
y.create.l HWIO_DIM_D00_DIM_DQ_RD_CDC_SW_MODE_CFG_ADDR A:0x60480854
y.create.l HWIO_DIM_D00_DIM_DQ_RD_CDC_TEST_CFG_ADDR A:0x60480858
y.create.l HWIO_DIM_D00_DIM_DQ_RD_CDC_SW_OVRD_CFG_ADDR A:0x6048085c
y.create.l HWIO_DIM_D00_DIM_DQ_RD_CDC_SLAVE_DDA_CFG_ADDR A:0x60480860
y.create.l HWIO_DIM_D00_DIM_DQ_RD_CDC_STATUS0_ADDR A:0x60480870
y.create.l HWIO_DIM_D00_DIM_DQ_RD_CDC_STATUS1_ADDR A:0x60480874
y.create.l HWIO_DIM_D00_DIM_DQ_RD_CDC_STATUS2_ADDR A:0x60480878
y.create.l HWIO_DIM_D00_DIM_DQ_RD_CDC_STATUS3_ADDR A:0x6048087c
y.create.l HWIO_DIM_D00_DIM_DQ_RD_CDC_STATUS4_ADDR A:0x60480880
y.create.l HWIO_DIM_D00_DIM_DQ_WR_CDC_OFFSET_CFG_ADDR A:0x604808ac
y.create.l HWIO_DIM_D00_DIM_DQ_WR_CDC_DELAY_CFG_ADDR A:0x604808b0
y.create.l HWIO_DIM_D00_DIM_DQ_WR_CDC_SW_MODE_CFG_ADDR A:0x604808b4
y.create.l HWIO_DIM_D00_DIM_DQ_WR_CDC_TEST_CFG_ADDR A:0x604808b8
y.create.l HWIO_DIM_D00_DIM_DQ_WR_CDC_SW_OVRD_CFG_ADDR A:0x604808bc
y.create.l HWIO_DIM_D00_DIM_DQ_WR_CDC_STATUS0_ADDR A:0x604808d0
y.create.l HWIO_DIM_D00_DIM_DQ_WR_CDC_STATUS1_ADDR A:0x604808d4
y.create.l HWIO_DIM_D00_DIM_DQ_WR_CDC_STATUS2_ADDR A:0x604808d8
y.create.l HWIO_DIM_D00_DIM_DQ_WR_CDC_STATUS3_ADDR A:0x604808dc
y.create.l HWIO_DIM_D00_DIM_DQ_DQ_IOC_SLV_CFG_ADDR A:0x60480900
y.create.l HWIO_DIM_D00_DIM_DQ_DQ_IOC_SLV_STATUS_ADDR A:0x60480904
y.create.l HWIO_DIM_D00_DIM_DQ_DQS_IOC_SLV_CFG_ADDR A:0x60480910
y.create.l HWIO_DIM_D00_DIM_DQ_DQS_IOC_SLV_STATUS_ADDR A:0x60480914
y.create.l HWIO_DIM_D01_DIM_DQ_TOP_CFG_ADDR A:0x60481000
y.create.l HWIO_DIM_D01_DIM_DQ_HW_INFO_ADDR A:0x60481004
y.create.l HWIO_DIM_D01_DIM_DQ_HW_VERSION_ADDR A:0x60481008
y.create.l HWIO_DIM_D01_DIM_DQ_PAD_CFG0_ADDR A:0x60481010
y.create.l HWIO_DIM_D01_DIM_DQ_PAD_CFG1_ADDR A:0x60481014
y.create.l HWIO_DIM_D01_DIM_DQ_PAD_CFG2_ADDR A:0x60481018
y.create.l HWIO_DIM_D01_DIM_DQ_DQ_SMT_STATUS_ADDR A:0x6048101c
y.create.l HWIO_DIM_D01_DIM_DQ_PAD_CFG3_ADDR A:0x60481020
y.create.l HWIO_DIM_D01_DDRPHY_DQ_MISR_CFG_ADDR A:0x6048100c
y.create.l HWIO_DIM_D01_DDRPHY_DQ_MISR_EVEN_STATUS_ADDR A:0x60481028
y.create.l HWIO_DIM_D01_DDRPHY_DQ_MISR_ODD_STATUS_ADDR A:0x6048102c
y.create.l HWIO_DIM_D01_DIM_DQ_CDC_CTLR_CFG0_ADDR A:0x60481030
y.create.l HWIO_DIM_D01_DIM_DQ_CDC_CTLR_CFG1_ADDR A:0x60481034
y.create.l HWIO_DIM_D01_DIM_DQ_CDC_CAL_TIMER_CFG0_ADDR A:0x60481038
y.create.l HWIO_DIM_D01_DIM_DQ_CDC_CAL_TIMER_CFG1_ADDR A:0x6048103c
y.create.l HWIO_DIM_D01_DIM_DQ_CDC_REFCOUNT_CFG_ADDR A:0x60481040
y.create.l HWIO_DIM_D01_DIM_DQ_CDC_COARSE_CAL_CFG_ADDR A:0x60481044
y.create.l HWIO_DIM_D01_DIM_DQ_CDC_RSVD_CFG_ADDR A:0x60481048
y.create.l HWIO_DIM_D01_DIM_DQ_RD_CDC_OFFSET_CFG_ADDR A:0x6048104c
y.create.l HWIO_DIM_D01_DIM_DQ_RD_CDC_DELAY_CFG_ADDR A:0x60481050
y.create.l HWIO_DIM_D01_DIM_DQ_RD_CDC_SW_MODE_CFG_ADDR A:0x60481054
y.create.l HWIO_DIM_D01_DIM_DQ_RD_CDC_TEST_CFG_ADDR A:0x60481058
y.create.l HWIO_DIM_D01_DIM_DQ_RD_CDC_SW_OVRD_CFG_ADDR A:0x6048105c
y.create.l HWIO_DIM_D01_DIM_DQ_RD_CDC_SLAVE_DDA_CFG_ADDR A:0x60481060
y.create.l HWIO_DIM_D01_DIM_DQ_RD_CDC_STATUS0_ADDR A:0x60481070
y.create.l HWIO_DIM_D01_DIM_DQ_RD_CDC_STATUS1_ADDR A:0x60481074
y.create.l HWIO_DIM_D01_DIM_DQ_RD_CDC_STATUS2_ADDR A:0x60481078
y.create.l HWIO_DIM_D01_DIM_DQ_RD_CDC_STATUS3_ADDR A:0x6048107c
y.create.l HWIO_DIM_D01_DIM_DQ_RD_CDC_STATUS4_ADDR A:0x60481080
y.create.l HWIO_DIM_D01_DIM_DQ_WR_CDC_OFFSET_CFG_ADDR A:0x604810ac
y.create.l HWIO_DIM_D01_DIM_DQ_WR_CDC_DELAY_CFG_ADDR A:0x604810b0
y.create.l HWIO_DIM_D01_DIM_DQ_WR_CDC_SW_MODE_CFG_ADDR A:0x604810b4
y.create.l HWIO_DIM_D01_DIM_DQ_WR_CDC_TEST_CFG_ADDR A:0x604810b8
y.create.l HWIO_DIM_D01_DIM_DQ_WR_CDC_SW_OVRD_CFG_ADDR A:0x604810bc
y.create.l HWIO_DIM_D01_DIM_DQ_WR_CDC_STATUS0_ADDR A:0x604810d0
y.create.l HWIO_DIM_D01_DIM_DQ_WR_CDC_STATUS1_ADDR A:0x604810d4
y.create.l HWIO_DIM_D01_DIM_DQ_WR_CDC_STATUS2_ADDR A:0x604810d8
y.create.l HWIO_DIM_D01_DIM_DQ_WR_CDC_STATUS3_ADDR A:0x604810dc
y.create.l HWIO_DIM_D01_DIM_DQ_DQ_IOC_SLV_CFG_ADDR A:0x60481100
y.create.l HWIO_DIM_D01_DIM_DQ_DQ_IOC_SLV_STATUS_ADDR A:0x60481104
y.create.l HWIO_DIM_D01_DIM_DQ_DQS_IOC_SLV_CFG_ADDR A:0x60481110
y.create.l HWIO_DIM_D01_DIM_DQ_DQS_IOC_SLV_STATUS_ADDR A:0x60481114
y.create.l HWIO_DIM_D02_DIM_DQ_TOP_CFG_ADDR A:0x60481800
y.create.l HWIO_DIM_D02_DIM_DQ_HW_INFO_ADDR A:0x60481804
y.create.l HWIO_DIM_D02_DIM_DQ_HW_VERSION_ADDR A:0x60481808
y.create.l HWIO_DIM_D02_DIM_DQ_PAD_CFG0_ADDR A:0x60481810
y.create.l HWIO_DIM_D02_DIM_DQ_PAD_CFG1_ADDR A:0x60481814
y.create.l HWIO_DIM_D02_DIM_DQ_PAD_CFG2_ADDR A:0x60481818
y.create.l HWIO_DIM_D02_DIM_DQ_DQ_SMT_STATUS_ADDR A:0x6048181c
y.create.l HWIO_DIM_D02_DIM_DQ_PAD_CFG3_ADDR A:0x60481820
y.create.l HWIO_DIM_D02_DDRPHY_DQ_MISR_CFG_ADDR A:0x6048180c
y.create.l HWIO_DIM_D02_DDRPHY_DQ_MISR_EVEN_STATUS_ADDR A:0x60481828
y.create.l HWIO_DIM_D02_DDRPHY_DQ_MISR_ODD_STATUS_ADDR A:0x6048182c
y.create.l HWIO_DIM_D02_DIM_DQ_CDC_CTLR_CFG0_ADDR A:0x60481830
y.create.l HWIO_DIM_D02_DIM_DQ_CDC_CTLR_CFG1_ADDR A:0x60481834
y.create.l HWIO_DIM_D02_DIM_DQ_CDC_CAL_TIMER_CFG0_ADDR A:0x60481838
y.create.l HWIO_DIM_D02_DIM_DQ_CDC_CAL_TIMER_CFG1_ADDR A:0x6048183c
y.create.l HWIO_DIM_D02_DIM_DQ_CDC_REFCOUNT_CFG_ADDR A:0x60481840
y.create.l HWIO_DIM_D02_DIM_DQ_CDC_COARSE_CAL_CFG_ADDR A:0x60481844
y.create.l HWIO_DIM_D02_DIM_DQ_CDC_RSVD_CFG_ADDR A:0x60481848
y.create.l HWIO_DIM_D02_DIM_DQ_RD_CDC_OFFSET_CFG_ADDR A:0x6048184c
y.create.l HWIO_DIM_D02_DIM_DQ_RD_CDC_DELAY_CFG_ADDR A:0x60481850
y.create.l HWIO_DIM_D02_DIM_DQ_RD_CDC_SW_MODE_CFG_ADDR A:0x60481854
y.create.l HWIO_DIM_D02_DIM_DQ_RD_CDC_TEST_CFG_ADDR A:0x60481858
y.create.l HWIO_DIM_D02_DIM_DQ_RD_CDC_SW_OVRD_CFG_ADDR A:0x6048185c
y.create.l HWIO_DIM_D02_DIM_DQ_RD_CDC_SLAVE_DDA_CFG_ADDR A:0x60481860
y.create.l HWIO_DIM_D02_DIM_DQ_RD_CDC_STATUS0_ADDR A:0x60481870
y.create.l HWIO_DIM_D02_DIM_DQ_RD_CDC_STATUS1_ADDR A:0x60481874
y.create.l HWIO_DIM_D02_DIM_DQ_RD_CDC_STATUS2_ADDR A:0x60481878
y.create.l HWIO_DIM_D02_DIM_DQ_RD_CDC_STATUS3_ADDR A:0x6048187c
y.create.l HWIO_DIM_D02_DIM_DQ_RD_CDC_STATUS4_ADDR A:0x60481880
y.create.l HWIO_DIM_D02_DIM_DQ_WR_CDC_OFFSET_CFG_ADDR A:0x604818ac
y.create.l HWIO_DIM_D02_DIM_DQ_WR_CDC_DELAY_CFG_ADDR A:0x604818b0
y.create.l HWIO_DIM_D02_DIM_DQ_WR_CDC_SW_MODE_CFG_ADDR A:0x604818b4
y.create.l HWIO_DIM_D02_DIM_DQ_WR_CDC_TEST_CFG_ADDR A:0x604818b8
y.create.l HWIO_DIM_D02_DIM_DQ_WR_CDC_SW_OVRD_CFG_ADDR A:0x604818bc
y.create.l HWIO_DIM_D02_DIM_DQ_WR_CDC_STATUS0_ADDR A:0x604818d0
y.create.l HWIO_DIM_D02_DIM_DQ_WR_CDC_STATUS1_ADDR A:0x604818d4
y.create.l HWIO_DIM_D02_DIM_DQ_WR_CDC_STATUS2_ADDR A:0x604818d8
y.create.l HWIO_DIM_D02_DIM_DQ_WR_CDC_STATUS3_ADDR A:0x604818dc
y.create.l HWIO_DIM_D02_DIM_DQ_DQ_IOC_SLV_CFG_ADDR A:0x60481900
y.create.l HWIO_DIM_D02_DIM_DQ_DQ_IOC_SLV_STATUS_ADDR A:0x60481904
y.create.l HWIO_DIM_D02_DIM_DQ_DQS_IOC_SLV_CFG_ADDR A:0x60481910
y.create.l HWIO_DIM_D02_DIM_DQ_DQS_IOC_SLV_STATUS_ADDR A:0x60481914
y.create.l HWIO_DIM_D03_DIM_DQ_TOP_CFG_ADDR A:0x60482000
y.create.l HWIO_DIM_D03_DIM_DQ_HW_INFO_ADDR A:0x60482004
y.create.l HWIO_DIM_D03_DIM_DQ_HW_VERSION_ADDR A:0x60482008
y.create.l HWIO_DIM_D03_DIM_DQ_PAD_CFG0_ADDR A:0x60482010
y.create.l HWIO_DIM_D03_DIM_DQ_PAD_CFG1_ADDR A:0x60482014
y.create.l HWIO_DIM_D03_DIM_DQ_PAD_CFG2_ADDR A:0x60482018
y.create.l HWIO_DIM_D03_DIM_DQ_DQ_SMT_STATUS_ADDR A:0x6048201c
y.create.l HWIO_DIM_D03_DIM_DQ_PAD_CFG3_ADDR A:0x60482020
y.create.l HWIO_DIM_D03_DDRPHY_DQ_MISR_CFG_ADDR A:0x6048200c
y.create.l HWIO_DIM_D03_DDRPHY_DQ_MISR_EVEN_STATUS_ADDR A:0x60482028
y.create.l HWIO_DIM_D03_DDRPHY_DQ_MISR_ODD_STATUS_ADDR A:0x6048202c
y.create.l HWIO_DIM_D03_DIM_DQ_CDC_CTLR_CFG0_ADDR A:0x60482030
y.create.l HWIO_DIM_D03_DIM_DQ_CDC_CTLR_CFG1_ADDR A:0x60482034
y.create.l HWIO_DIM_D03_DIM_DQ_CDC_CAL_TIMER_CFG0_ADDR A:0x60482038
y.create.l HWIO_DIM_D03_DIM_DQ_CDC_CAL_TIMER_CFG1_ADDR A:0x6048203c
y.create.l HWIO_DIM_D03_DIM_DQ_CDC_REFCOUNT_CFG_ADDR A:0x60482040
y.create.l HWIO_DIM_D03_DIM_DQ_CDC_COARSE_CAL_CFG_ADDR A:0x60482044
y.create.l HWIO_DIM_D03_DIM_DQ_CDC_RSVD_CFG_ADDR A:0x60482048
y.create.l HWIO_DIM_D03_DIM_DQ_RD_CDC_OFFSET_CFG_ADDR A:0x6048204c
y.create.l HWIO_DIM_D03_DIM_DQ_RD_CDC_DELAY_CFG_ADDR A:0x60482050
y.create.l HWIO_DIM_D03_DIM_DQ_RD_CDC_SW_MODE_CFG_ADDR A:0x60482054
y.create.l HWIO_DIM_D03_DIM_DQ_RD_CDC_TEST_CFG_ADDR A:0x60482058
y.create.l HWIO_DIM_D03_DIM_DQ_RD_CDC_SW_OVRD_CFG_ADDR A:0x6048205c
y.create.l HWIO_DIM_D03_DIM_DQ_RD_CDC_SLAVE_DDA_CFG_ADDR A:0x60482060
y.create.l HWIO_DIM_D03_DIM_DQ_RD_CDC_STATUS0_ADDR A:0x60482070
y.create.l HWIO_DIM_D03_DIM_DQ_RD_CDC_STATUS1_ADDR A:0x60482074
y.create.l HWIO_DIM_D03_DIM_DQ_RD_CDC_STATUS2_ADDR A:0x60482078
y.create.l HWIO_DIM_D03_DIM_DQ_RD_CDC_STATUS3_ADDR A:0x6048207c
y.create.l HWIO_DIM_D03_DIM_DQ_RD_CDC_STATUS4_ADDR A:0x60482080
y.create.l HWIO_DIM_D03_DIM_DQ_WR_CDC_OFFSET_CFG_ADDR A:0x604820ac
y.create.l HWIO_DIM_D03_DIM_DQ_WR_CDC_DELAY_CFG_ADDR A:0x604820b0
y.create.l HWIO_DIM_D03_DIM_DQ_WR_CDC_SW_MODE_CFG_ADDR A:0x604820b4
y.create.l HWIO_DIM_D03_DIM_DQ_WR_CDC_TEST_CFG_ADDR A:0x604820b8
y.create.l HWIO_DIM_D03_DIM_DQ_WR_CDC_SW_OVRD_CFG_ADDR A:0x604820bc
y.create.l HWIO_DIM_D03_DIM_DQ_WR_CDC_STATUS0_ADDR A:0x604820d0
y.create.l HWIO_DIM_D03_DIM_DQ_WR_CDC_STATUS1_ADDR A:0x604820d4
y.create.l HWIO_DIM_D03_DIM_DQ_WR_CDC_STATUS2_ADDR A:0x604820d8
y.create.l HWIO_DIM_D03_DIM_DQ_WR_CDC_STATUS3_ADDR A:0x604820dc
y.create.l HWIO_DIM_D03_DIM_DQ_DQ_IOC_SLV_CFG_ADDR A:0x60482100
y.create.l HWIO_DIM_D03_DIM_DQ_DQ_IOC_SLV_STATUS_ADDR A:0x60482104
y.create.l HWIO_DIM_D03_DIM_DQ_DQS_IOC_SLV_CFG_ADDR A:0x60482110
y.create.l HWIO_DIM_D03_DIM_DQ_DQS_IOC_SLV_STATUS_ADDR A:0x60482114
y.create.l HWIO_EBI1_HW_VERSION_ADDR A:0x6049f000
y.create.l HWIO_EBI1_HW_INFO_ADDR A:0x6049f004
y.create.l HWIO_EBI1_AHB2PHY_BROADCAST_EN_CFG_LOWER_ADDR A:0x6049f008
y.create.l HWIO_EBI1_AHB2PHY_BROADCAST_EN_CFG_UPPER_ADDR A:0x6049f00c
y.create.l HWIO_EBI1_AHB2PHY_TOP_CFG_ADDR A:0x6049f010
y.create.l HWIO_EBI1_AHB2PHY_DEBUG_BUS_CFG_ADDR A:0x6049f014
y.create.l HWIO_EBI1_AHB2PHY_BROADCAST_ADDRESS_SPACE_0_ADDR A:0x6049f800
y.create.l HWIO_EBI1_AHB2PHY_BROADCAST_ADDRESS_SPACE_1_ADDR A:0x6049f804
y.create.l HWIO_EBI1_AHB2PHY_BROADCAST_ADDRESS_SPACE_2_ADDR A:0x6049f808
y.create.l HWIO_EBI1_AHB2PHY_BROADCAST_ADDRESS_SPACE_3_ADDR A:0x6049f80c
y.create.l HWIO_EBI1_AHB2PHY_BROADCAST_ADDRESS_SPACE_4_ADDR A:0x6049f810
y.create.l HWIO_EBI1_AHB2PHY_BROADCAST_ADDRESS_SPACE_5_ADDR A:0x6049f814
y.create.l HWIO_EBI1_AHB2PHY_BROADCAST_ADDRESS_SPACE_6_ADDR A:0x6049f818
y.create.l HWIO_EBI1_AHB2PHY_BROADCAST_ADDRESS_SPACE_7_ADDR A:0x6049f81c
y.create.l HWIO_EBI1_AHB2PHY_BROADCAST_ADDRESS_SPACE_8_ADDR A:0x6049f820
y.create.l HWIO_EBI1_AHB2PHY_BROADCAST_ADDRESS_SPACE_9_ADDR A:0x6049f824
y.create.l HWIO_EMAC_0_EMAC_DMA_MAS_CTRL_ADDR A:0x67c41400
y.create.l HWIO_EMAC_0_EMAC_TIMER_INIT_VALUE_ADDR A:0x67c41404
y.create.l HWIO_EMAC_0_EMAC_IRQ_MOD_TIM_INIT_ADDR A:0x67c41408
y.create.l HWIO_EMAC_0_EMAC_BLK_IDLE_STS_ADDR A:0x67c4140c
y.create.l HWIO_EMAC_0_EMAC_MDIO_CTRL_ADDR A:0x67c41414
y.create.l HWIO_EMAC_0_EMAC_PHY_STS_ADDR A:0x67c41418
y.create.l HWIO_EMAC_0_EMAC_PHY_LINK_DELAY_ADDR A:0x67c4141c
y.create.l HWIO_EMAC_0_EMAC_SYS_ALIV_CTRL_ADDR A:0x67c41434
y.create.l HWIO_EMAC_0_EMAC_MDIO_EX_CTRL_ADDR A:0x67c41440
y.create.l HWIO_EMAC_0_EMAC_MAC_CTRL_ADDR A:0x67c41480
y.create.l HWIO_EMAC_0_EMAC_MAC_IPGIFG_CTRL_ADDR A:0x67c41484
y.create.l HWIO_EMAC_0_EMAC_MAC_STA_ADDR0_ADDR A:0x67c41488
y.create.l HWIO_EMAC_0_EMAC_MAC_STA_ADDR1_ADDR A:0x67c4148c
y.create.l HWIO_EMAC_0_EMAC_HASH_TAB_REG0_ADDR A:0x67c41490
y.create.l HWIO_EMAC_0_EMAC_HASH_TAB_REG1_ADDR A:0x67c41494
y.create.l HWIO_EMAC_0_EMAC_MAC_HALF_DPLX_CTRL_ADDR A:0x67c41498
y.create.l HWIO_EMAC_0_EMAC_MAX_FRAM_LEN_CTRL_ADDR A:0x67c4149c
y.create.l HWIO_EMAC_0_EMAC_WOL_CTRL0_ADDR A:0x67c414a0
y.create.l HWIO_EMAC_0_EMAC_WOL_CTRL1_ADDR A:0x67c414a4
y.create.l HWIO_EMAC_0_EMAC_WOL_CTRL2_ADDR A:0x67c414a8
y.create.l HWIO_EMAC_0_EMAC_RSS_KEY0_ADDR A:0x67c414b0
y.create.l HWIO_EMAC_0_EMAC_RSS_KEY1_ADDR A:0x67c414b4
y.create.l HWIO_EMAC_0_EMAC_RSS_KEY2_ADDR A:0x67c414b8
y.create.l HWIO_EMAC_0_EMAC_RSS_KEY3_ADDR A:0x67c414bc
y.create.l HWIO_EMAC_0_EMAC_RSS_KEY4_ADDR A:0x67c414c0
y.create.l HWIO_EMAC_0_EMAC_RSS_KEY5_ADDR A:0x67c414c4
y.create.l HWIO_EMAC_0_EMAC_RSS_KEY6_ADDR A:0x67c414c8
y.create.l HWIO_EMAC_0_EMAC_RSS_KEY7_ADDR A:0x67c414cc
y.create.l HWIO_EMAC_0_EMAC_RSS_KEY8_ADDR A:0x67c414d0
y.create.l HWIO_EMAC_0_EMAC_RSS_KEY9_ADDR A:0x67c414d4
y.create.l HWIO_EMAC_0_EMAC_H1TPD_BASE_ADDR_LO_ADDR A:0x67c414e0
y.create.l HWIO_EMAC_0_EMAC_H2TPD_BASE_ADDR_LO_ADDR A:0x67c414e4
y.create.l HWIO_EMAC_0_EMAC_H3TPD_BASE_ADDR_LO_ADDR A:0x67c414e8
y.create.l HWIO_EMAC_0_EMAC_INTER_SRAM_PART0_ADDR A:0x67c41500
y.create.l HWIO_EMAC_0_EMAC_INTER_SRAM_PART10_ADDR A:0x67c41504
y.create.l HWIO_EMAC_0_EMAC_INTER_SRAM_PART11_ADDR A:0x67c41508
y.create.l HWIO_EMAC_0_EMAC_INTER_SRAM_PART12_ADDR A:0x67c4150c
y.create.l HWIO_EMAC_0_EMAC_INTER_SRAM_PART1_ADDR A:0x67c41510
y.create.l HWIO_EMAC_0_EMAC_INTER_SRAM_PART2_ADDR A:0x67c41518
y.create.l HWIO_EMAC_0_EMAC_INTER_SRAM_PART3_ADDR A:0x67c4151c
y.create.l HWIO_EMAC_0_EMAC_INTER_SRAM_PART4_ADDR A:0x67c41520
y.create.l HWIO_EMAC_0_EMAC_INTER_SRAM_PART5_ADDR A:0x67c41524
y.create.l HWIO_EMAC_0_EMAC_INTER_SRAM_PART6_ADDR A:0x67c41528
y.create.l HWIO_EMAC_0_EMAC_INTER_SRAM_PART7_ADDR A:0x67c4152c
y.create.l HWIO_EMAC_0_EMAC_INTER_SRAM_PART8_ADDR A:0x67c41530
y.create.l HWIO_EMAC_0_EMAC_INTER_SRAM_PART9_ADDR A:0x67c41534
y.create.l HWIO_EMAC_0_EMAC_DESC_CTRL_0_ADDR A:0x67c41540
y.create.l HWIO_EMAC_0_EMAC_DESC_CTRL_1_ADDR A:0x67c41544
y.create.l HWIO_EMAC_0_EMAC_DESC_CTRL_2_ADDR A:0x67c41550
y.create.l HWIO_EMAC_0_EMAC_DESC_CTRL_10_ADDR A:0x67c41554
y.create.l HWIO_EMAC_0_EMAC_DESC_CTRL_12_ADDR A:0x67c41558
y.create.l HWIO_EMAC_0_EMAC_DESC_CTRL_13_ADDR A:0x67c4155c
y.create.l HWIO_EMAC_0_EMAC_DESC_CTRL_3_ADDR A:0x67c41560
y.create.l HWIO_EMAC_0_EMAC_DESC_CTRL_4_ADDR A:0x67c41564
y.create.l HWIO_EMAC_0_EMAC_DESC_CTRL_5_ADDR A:0x67c41568
y.create.l HWIO_EMAC_0_EMAC_DESC_CTRL_14_ADDR A:0x67c4156c
y.create.l HWIO_EMAC_0_EMAC_DESC_CTRL_15_ADDR A:0x67c41570
y.create.l HWIO_EMAC_0_EMAC_DESC_CTRL_16_ADDR A:0x67c41574
y.create.l HWIO_EMAC_0_EMAC_DESC_CTRL_6_ADDR A:0x67c41578
y.create.l HWIO_EMAC_0_EMAC_DESC_CTRL_7_ADDR A:0x67c4157c
y.create.l HWIO_EMAC_0_EMAC_DESC_CTRL_8_ADDR A:0x67c41580
y.create.l HWIO_EMAC_0_EMAC_DESC_CTRL_9_ADDR A:0x67c41584
y.create.l HWIO_EMAC_0_EMAC_DESC_CTRL_11_ADDR A:0x67c41588
y.create.l HWIO_EMAC_0_EMAC_TXQ_CTRL_0_ADDR A:0x67c41590
y.create.l HWIO_EMAC_0_EMAC_TXQ_CTRL_1_ADDR A:0x67c41594
y.create.l HWIO_EMAC_0_EMAC_TXQ_CTRL_2_ADDR A:0x67c41598
y.create.l HWIO_EMAC_0_EMAC_RXQ_CTRL_0_ADDR A:0x67c415a0
y.create.l HWIO_EMAC_0_EMAC_RXQ_CTRL_1_ADDR A:0x67c415a4
y.create.l HWIO_EMAC_0_EMAC_RXQ_CTRL_2_ADDR A:0x67c415a8
y.create.l HWIO_EMAC_0_EMAC_RXQ_CTRL_3_ADDR A:0x67c415ac
y.create.l HWIO_EMAC_0_EMAC_RSS_HASH_VALUE_ADDR A:0x67c415b0
y.create.l HWIO_EMAC_0_EMAC_RSS_HASH_FLAG_ADDR A:0x67c415b4
y.create.l HWIO_EMAC_0_EMAC_BASE_CPU_NUMBER_ADDR A:0x67c415b8
y.create.l HWIO_EMAC_0_EMAC_DMA_CTRL_ADDR A:0x67c415c0
y.create.l HWIO_EMAC_0_EMAC_MAILBOX_14_ADDR A:0x67c415dc
y.create.l HWIO_EMAC_0_EMAC_MAILBOX_0_ADDR A:0x67c415e0
y.create.l HWIO_EMAC_0_EMAC_MAILBOX_5_ADDR A:0x67c415e4
y.create.l HWIO_EMAC_0_EMAC_MAILBOX_6_ADDR A:0x67c415e8
y.create.l HWIO_EMAC_0_EMAC_MAILBOX_13_ADDR A:0x67c415ec
y.create.l HWIO_EMAC_0_EMAC_MAILBOX_1_ADDR A:0x67c415f0
y.create.l HWIO_EMAC_0_EMAC_MAILBOX_2_ADDR A:0x67c415f4
y.create.l HWIO_EMAC_0_EMAC_MAILBOX_3_ADDR A:0x67c415f8
y.create.l HWIO_EMAC_0_EMAC_MAILBOX_4_ADDR A:0x67c415fc
y.create.l HWIO_EMAC_0_EMAC_INT_STATUS_ADDR A:0x67c41600
y.create.l HWIO_EMAC_0_EMAC_INT_MASK_ADDR A:0x67c41604
y.create.l HWIO_EMAC_0_EMAC_INT_RETRIG_INIT_ADDR A:0x67c41608
y.create.l HWIO_EMAC_0_EMAC_MAILBOX_11_ADDR A:0x67c4160c
y.create.l HWIO_EMAC_0_EMAC_AXI_MAST_CTRL_ADDR A:0x67c41610
y.create.l HWIO_EMAC_0_EMAC_MAILBOX_12_ADDR A:0x67c41614
y.create.l HWIO_EMAC_0_EMAC_MAILBOX_9_ADDR A:0x67c41618
y.create.l HWIO_EMAC_0_EMAC_MAILBOX_10_ADDR A:0x67c4161c
y.create.l HWIO_EMAC_0_EMAC_ATHR_HEADER_CTRL_ADDR A:0x67c41620
y.create.l HWIO_EMAC_0_EMAC_VLAN_TPD_CFIG_ADDR A:0x67c41624
y.create.l HWIO_EMAC_0_EMAC_RXMAC_STATC_REG0_ADDR A:0x67c41700
y.create.l HWIO_EMAC_0_EMAC_RXMAC_STATC_REG1_ADDR A:0x67c41704
y.create.l HWIO_EMAC_0_EMAC_RXMAC_STATC_REG2_ADDR A:0x67c41708
y.create.l HWIO_EMAC_0_EMAC_RXMAC_STATC_REG3_ADDR A:0x67c4170c
y.create.l HWIO_EMAC_0_EMAC_RXMAC_STATC_REG4_ADDR A:0x67c41710
y.create.l HWIO_EMAC_0_EMAC_RXMAC_STATC_REG5_ADDR A:0x67c41714
y.create.l HWIO_EMAC_0_EMAC_RXMAC_STATC_REG6_ADDR A:0x67c41718
y.create.l HWIO_EMAC_0_EMAC_RXMAC_STATC_REG7_ADDR A:0x67c4171c
y.create.l HWIO_EMAC_0_EMAC_RXMAC_STATC_REG8_ADDR A:0x67c41720
y.create.l HWIO_EMAC_0_EMAC_RXMAC_STATC_REG9_ADDR A:0x67c41724
y.create.l HWIO_EMAC_0_EMAC_RXMAC_STATC_REG10_ADDR A:0x67c41728
y.create.l HWIO_EMAC_0_EMAC_RXMAC_STATC_REG11_ADDR A:0x67c4172c
y.create.l HWIO_EMAC_0_EMAC_RXMAC_STATC_REG12_ADDR A:0x67c41730
y.create.l HWIO_EMAC_0_EMAC_RXMAC_STATC_REG13_ADDR A:0x67c41734
y.create.l HWIO_EMAC_0_EMAC_RXMAC_STATC_REG14_ADDR A:0x67c41738
y.create.l HWIO_EMAC_0_EMAC_RXMAC_STATC_REG15_ADDR A:0x67c4173c
y.create.l HWIO_EMAC_0_EMAC_RXMAC_STATC_REG16_ADDR A:0x67c41740
y.create.l HWIO_EMAC_0_EMAC_RXMAC_STATC_REG17_ADDR A:0x67c41744
y.create.l HWIO_EMAC_0_EMAC_RXMAC_STATC_REG18_ADDR A:0x67c41748
y.create.l HWIO_EMAC_0_EMAC_RXMAC_STATC_REG19_ADDR A:0x67c4174c
y.create.l HWIO_EMAC_0_EMAC_RXMAC_STATC_REG20_ADDR A:0x67c41750
y.create.l HWIO_EMAC_0_EMAC_RXMAC_STATC_REG21_ADDR A:0x67c41754
y.create.l HWIO_EMAC_0_EMAC_RXMAC_STATC_REG22_ADDR A:0x67c41758
y.create.l HWIO_EMAC_0_EMAC_TXMAC_STATC_REG0_ADDR A:0x67c41760
y.create.l HWIO_EMAC_0_EMAC_TXMAC_STATC_REG1_ADDR A:0x67c41764
y.create.l HWIO_EMAC_0_EMAC_TXMAC_STATC_REG2_ADDR A:0x67c41768
y.create.l HWIO_EMAC_0_EMAC_TXMAC_STATC_REG3_ADDR A:0x67c4176c
y.create.l HWIO_EMAC_0_EMAC_TXMAC_STATC_REG4_ADDR A:0x67c41770
y.create.l HWIO_EMAC_0_EMAC_TXMAC_STATC_REG5_ADDR A:0x67c41774
y.create.l HWIO_EMAC_0_EMAC_TXMAC_STATC_REG6_ADDR A:0x67c41778
y.create.l HWIO_EMAC_0_EMAC_TXMAC_STATC_REG7_ADDR A:0x67c4177c
y.create.l HWIO_EMAC_0_EMAC_TXMAC_STATC_REG8_ADDR A:0x67c41780
y.create.l HWIO_EMAC_0_EMAC_TXMAC_STATC_REG9_ADDR A:0x67c41784
y.create.l HWIO_EMAC_0_EMAC_TXMAC_STATC_REG10_ADDR A:0x67c41788
y.create.l HWIO_EMAC_0_EMAC_TXMAC_STATC_REG11_ADDR A:0x67c4178c
y.create.l HWIO_EMAC_0_EMAC_TXMAC_STATC_REG12_ADDR A:0x67c41790
y.create.l HWIO_EMAC_0_EMAC_TXMAC_STATC_REG13_ADDR A:0x67c41794
y.create.l HWIO_EMAC_0_EMAC_TXMAC_STATC_REG14_ADDR A:0x67c41798
y.create.l HWIO_EMAC_0_EMAC_TXMAC_STATC_REG15_ADDR A:0x67c4179c
y.create.l HWIO_EMAC_0_EMAC_TXMAC_STATC_REG16_ADDR A:0x67c417a0
y.create.l HWIO_EMAC_0_EMAC_TXMAC_STATC_REG17_ADDR A:0x67c417a4
y.create.l HWIO_EMAC_0_EMAC_TXMAC_STATC_REG18_ADDR A:0x67c417a8
y.create.l HWIO_EMAC_0_EMAC_TXMAC_STATC_REG19_ADDR A:0x67c417ac
y.create.l HWIO_EMAC_0_EMAC_TXMAC_STATC_REG20_ADDR A:0x67c417b0
y.create.l HWIO_EMAC_0_EMAC_TXMAC_STATC_REG21_ADDR A:0x67c417b4
y.create.l HWIO_EMAC_0_EMAC_TXMAC_STATC_REG22_ADDR A:0x67c417b8
y.create.l HWIO_EMAC_0_EMAC_TXMAC_STATC_REG23_ADDR A:0x67c417bc
y.create.l HWIO_EMAC_0_EMAC_TXMAC_STATC_REG24_ADDR A:0x67c417c0
y.create.l HWIO_EMAC_0_EMAC_SW_CTRL_0_ADDR A:0x67c41800
y.create.l HWIO_EMAC_0_EMAC_SW_CTRL_1_ADDR A:0x67c41804
y.create.l HWIO_EMAC_0_EMAC_SW_CTRL_2_ADDR A:0x67c41808
y.create.l HWIO_EMAC_0_EMAC_SW_CTRL_3_ADDR A:0x67c4180c
y.create.l HWIO_EMAC_0_EMAC_CLK_GATE_CTRL_ADDR A:0x67c41814
y.create.l HWIO_EMAC_0_EMAC_DBG_CTRL_ADDR A:0x67c41900
y.create.l HWIO_EMAC_0_EMAC_DBG_DATA_ADDR A:0x67c41904
y.create.l HWIO_EMAC_0_EMAC_WEIGHT_RR_ADDR A:0x67c41938
y.create.l HWIO_EMAC_0_EMAC_TPD_CTRL_ADDR A:0x67c4193c
y.create.l HWIO_EMAC_0_EMAC_ROUND_NUMBER_CTRL_ADDR A:0x67c41940
y.create.l HWIO_EMAC_0_EMAC_CORE_HW_VERSION_ADDR A:0x67c41974
y.create.l HWIO_EMAC_0_EMAC_MISC_CTRL_ADDR A:0x67c41990
y.create.l HWIO_EMAC_0_EMAC_MAILBOX_7_ADDR A:0x67c419e0
y.create.l HWIO_EMAC_0_EMAC_MAILBOX_8_ADDR A:0x67c419e4
y.create.l HWIO_EMAC_0_EMAC_DESC_CTRL_17_ADDR A:0x67c419f0
y.create.l HWIO_EMAC_0_EMAC_DESC_CTRL_18_ADDR A:0x67c419f4
y.create.l HWIO_EMAC_0_EMAC_INTER_SRAM_PART13_ADDR A:0x67c419f8
y.create.l HWIO_EMAC_0_EMAC_IDT_TABLE0_ADDR A:0x67c41b00
y.create.l HWIO_EMAC_0_EMAC_IDT_TABLE1_ADDR A:0x67c41b04
y.create.l HWIO_EMAC_0_EMAC_IDT_TABLE2_ADDR A:0x67c41b08
y.create.l HWIO_EMAC_0_EMAC_IDT_TABLE3_ADDR A:0x67c41b0c
y.create.l HWIO_EMAC_0_EMAC_IDT_TABLE4_ADDR A:0x67c41b10
y.create.l HWIO_EMAC_0_EMAC_IDT_TABLE5_ADDR A:0x67c41b14
y.create.l HWIO_EMAC_0_EMAC_IDT_TABLE6_ADDR A:0x67c41b18
y.create.l HWIO_EMAC_0_EMAC_IDT_TABLE7_ADDR A:0x67c41b1c
y.create.l HWIO_EMAC_0_EMAC_IDT_TABLE8_ADDR A:0x67c41b20
y.create.l HWIO_EMAC_0_EMAC_IDT_TABLE9_ADDR A:0x67c41b24
y.create.l HWIO_EMAC_0_EMAC_IDT_TABLE10_ADDR A:0x67c41b28
y.create.l HWIO_EMAC_0_EMAC_IDT_TABLE11_ADDR A:0x67c41b2c
y.create.l HWIO_EMAC_0_EMAC_IDT_TABLE12_ADDR A:0x67c41b30
y.create.l HWIO_EMAC_0_EMAC_IDT_TABLE13_ADDR A:0x67c41b34
y.create.l HWIO_EMAC_0_EMAC_IDT_TABLE14_ADDR A:0x67c41b38
y.create.l HWIO_EMAC_0_EMAC_IDT_TABLE15_ADDR A:0x67c41b3c
y.create.l HWIO_EMAC_0_EMAC_IDT_TABLE16_ADDR A:0x67c41b40
y.create.l HWIO_EMAC_0_EMAC_IDT_TABLE17_ADDR A:0x67c41b44
y.create.l HWIO_EMAC_0_EMAC_IDT_TABLE18_ADDR A:0x67c41b48
y.create.l HWIO_EMAC_0_EMAC_IDT_TABLE19_ADDR A:0x67c41b4c
y.create.l HWIO_EMAC_0_EMAC_IDT_TABLE20_ADDR A:0x67c41b50
y.create.l HWIO_EMAC_0_EMAC_IDT_TABLE21_ADDR A:0x67c41b54
y.create.l HWIO_EMAC_0_EMAC_IDT_TABLE22_ADDR A:0x67c41b58
y.create.l HWIO_EMAC_0_EMAC_IDT_TABLE23_ADDR A:0x67c41b5c
y.create.l HWIO_EMAC_0_EMAC_IDT_TABLE24_ADDR A:0x67c41b60
y.create.l HWIO_EMAC_0_EMAC_IDT_TABLE25_ADDR A:0x67c41b64
y.create.l HWIO_EMAC_0_EMAC_IDT_TABLE26_ADDR A:0x67c41b68
y.create.l HWIO_EMAC_0_EMAC_IDT_TABLE27_ADDR A:0x67c41b6c
y.create.l HWIO_EMAC_0_EMAC_IDT_TABLE28_ADDR A:0x67c41b70
y.create.l HWIO_EMAC_0_EMAC_IDT_TABLE29_ADDR A:0x67c41b74
y.create.l HWIO_EMAC_0_EMAC_IDT_TABLE30_ADDR A:0x67c41b78
y.create.l HWIO_EMAC_0_EMAC_IDT_TABLE31_ADDR A:0x67c41b7c
y.create.l HWIO_EMAC_0_EMAC_VMQ_FILTER0_LO_ADDR A:0x67c41b80
y.create.l HWIO_EMAC_0_EMAC_VMQ_FILTER0_HI_ADDR A:0x67c41b84
y.create.l HWIO_EMAC_0_EMAC_VMQ_FILTER1_LO_ADDR A:0x67c41b88
y.create.l HWIO_EMAC_0_EMAC_VMQ_FILTER1_HI_ADDR A:0x67c41b8c
y.create.l HWIO_EMAC_0_EMAC_VMQ_FILTER2_LO_ADDR A:0x67c41b90
y.create.l HWIO_EMAC_0_EMAC_VMQ_FILTER2_HI_ADDR A:0x67c41b94
y.create.l HWIO_EMAC_0_EMAC_VMQ_FILTER3_LO_ADDR A:0x67c41b98
y.create.l HWIO_EMAC_0_EMAC_VMQ_FILTER3_HI_ADDR A:0x67c41b9c
y.create.l HWIO_EMAC_0_EMAC_VMQ_FILTER4_LO_ADDR A:0x67c41ba0
y.create.l HWIO_EMAC_0_EMAC_VMQ_FILTER4_HI_ADDR A:0x67c41ba4
y.create.l HWIO_EMAC_0_EMAC_VMQ_FILTER5_LO_ADDR A:0x67c41ba8
y.create.l HWIO_EMAC_0_EMAC_VMQ_FILTER5_HI_ADDR A:0x67c41bac
y.create.l HWIO_EMAC_0_EMAC_VMQ_FILTER6_LO_ADDR A:0x67c41bb0
y.create.l HWIO_EMAC_0_EMAC_VMQ_FILTER6_HI_ADDR A:0x67c41bb4
y.create.l HWIO_EMAC_0_EMAC_VMQ_FILTER7_LO_ADDR A:0x67c41bb8
y.create.l HWIO_EMAC_0_EMAC_VMQ_FILTER7_HI_ADDR A:0x67c41bbc
y.create.l HWIO_EMAC_0_EMAC_VMQ_FILTER_MAP_ADDR A:0x67c41bc0
y.create.l HWIO_EMAC_0_EMAC_VMQ_FILTER_EN_CTRL_ADDR A:0x67c41bc4
y.create.l HWIO_EMAC_0_EMAC_RXMAC_STATC_REG23_ADDR A:0x67c41bc8
y.create.l HWIO_EMAC_0_EMAC_RXMAC_STATC_REG24_ADDR A:0x67c41bcc
y.create.l HWIO_EMAC_0_EMAC_TXMAC_STATC_REG25_ADDR A:0x67c41bd0
y.create.l HWIO_EMAC_0_EMAC_MAILBOX_15_ADDR A:0x67c41bd4
y.create.l HWIO_EMAC_0_EMAC_MAILBOX_16_ADDR A:0x67c41bd8
y.create.l HWIO_EMAC_0_EMAC_TXMAC_STATC_REG26_ADDR A:0x67c41bdc
y.create.l HWIO_EMAC_0_EMAC_TXMAC_STATC_REG27_ADDR A:0x67c41be0
y.create.l HWIO_EMAC_0_EMAC_TXMAC_STATC_REG28_ADDR A:0x67c41be4
y.create.l HWIO_EMAC_0_EMAC_TXMAC_STATC_REG29_ADDR A:0x67c41be8
y.create.l HWIO_EMAC_0_EMAC_TXMAC_STATC_REG30_ADDR A:0x67c41bec
y.create.l HWIO_EMAC_0_EMAC_INT1_MASK_ADDR A:0x67c41bf0
y.create.l HWIO_EMAC_0_EMAC_INT1_STATUS_ADDR A:0x67c41bf4
y.create.l HWIO_EMAC_0_EMAC_INT2_MASK_ADDR A:0x67c41bf8
y.create.l HWIO_EMAC_0_EMAC_INT2_STATUS_ADDR A:0x67c41bfc
y.create.l HWIO_EMAC_0_EMAC_INT3_MASK_ADDR A:0x67c41c00
y.create.l HWIO_EMAC_0_EMAC_INT3_STATUS_ADDR A:0x67c41c04
y.create.l HWIO_EMAC_0_EMAC_EMAC_RAM0_ADDR A:0x67c48000
y.create.l HWIO_EMAC_0_EMAC_EMAC_RAM1_ADDR A:0x67c48004
y.create.l HWIO_EMAC_0_EMAC_EMAC_RAM2_ADDR A:0x67c48008
y.create.l HWIO_EMAC_0_EMAC_EMAC_RAM3_ADDR A:0x67c4800c
y.create.l HWIO_EMAC_0_EMAC_EMAC_RAM4_ADDR A:0x67c48010
y.create.l HWIO_EMAC_0_EMAC_EMAC_RAM5_ADDR A:0x67c48014
y.create.l HWIO_EMAC_0_EMAC_EMAC_RAM6_ADDR A:0x67c48018
y.create.l HWIO_EMAC_0_EMAC_EMAC_RAM7_ADDR A:0x67c4801c
y.create.l HWIO_EMAC_0_EMAC_EMAC_RAM8_ADDR A:0x67c48020
y.create.l HWIO_EMAC_0_EMAC_EMAC_RAM9_ADDR A:0x67c48024
y.create.l HWIO_EMAC_0_EMAC_EMAC_WRAPPER_CSR1_ADDR A:0x67c56000
y.create.l HWIO_EMAC_0_EMAC_EMAC_WRAPPER_CSR2_ADDR A:0x67c56004
y.create.l HWIO_EMAC_0_EMAC_EMAC_WRAPPER_CSR3_ADDR A:0x67c56008
y.create.l HWIO_EMAC_0_EMAC_EMAC_WRAPPER_CSR4_ADDR A:0x67c5600c
y.create.l HWIO_EMAC_0_EMAC_EMAC_WRAPPER_CSR5_ADDR A:0x67c56010
y.create.l HWIO_EMAC_0_EMAC_EMAC_WRAPPER_CSR6_ADDR A:0x67c56014
y.create.l HWIO_EMAC_0_EMAC_EMAC_WRAPPER_CSR7_ADDR A:0x67c56018
y.create.l HWIO_EMAC_0_EMAC_EMAC_WRAPPER_CSR8_ADDR A:0x67c5601c
y.create.l HWIO_EMAC_0_EMAC_EMAC_WRAPPER_CSR9_ADDR A:0x67c56020
y.create.l HWIO_EMAC_0_EMAC_EMAC_WRAPPER_CSR10_ADDR A:0x67c56024
y.create.l HWIO_EMAC_0_EMAC_EMAC_WRAPPER_CSR11_ADDR A:0x67c56028
y.create.l HWIO_EMAC_0_EMAC_EMAC_WRAPPER_CSR12_ADDR A:0x67c5602c
y.create.l HWIO_EMAC_0_EMAC_EMAC_WRAPPER_CSR13_ADDR A:0x67c56030
y.create.l HWIO_EMAC_0_EMAC_EMAC_WRAPPER_CSR14_ADDR A:0x67c56034
y.create.l HWIO_EMAC_0_EMAC_EMAC_WRAPPER_CSR15_ADDR A:0x67c56038
y.create.l HWIO_EMAC_0_EMAC_EMAC_WRAPPER_CSR16_ADDR A:0x67c5603c
y.create.l HWIO_EMAC_0_EMAC_EMAC_WRAPPER_CSR17_ADDR A:0x67c56040
y.create.l HWIO_EMAC_0_EMAC_EMAC_WRAPPER_CSR18_ADDR A:0x67c56044
y.create.l HWIO_EMAC_0_EMAC_EMAC_WRAPPER_CSR19_ADDR A:0x67c56048
y.create.l HWIO_EMAC_0_EMAC_EMAC_WRAPPER_STATUS_ADDR A:0x67c56100
y.create.l HWIO_EMAC_0_EMAC_EMAC_WRAPPER_TX_TS_LO_ADDR A:0x67c56104
y.create.l HWIO_EMAC_0_EMAC_EMAC_WRAPPER_TX_TS_HI_ADDR A:0x67c56108
y.create.l HWIO_EMAC_0_EMAC_EMAC_WRAPPER_TX_TS_INX_ADDR A:0x67c5610c
y.create.l HWIO_EMAC_0_EMAC_EMAC_WRAPPER_IRQ_STATUS_ADDR A:0x67c56110
y.create.l HWIO_EMAC_0_EMAC_P1588_CTRL_REG_ADDR A:0x67c5c048
y.create.l HWIO_EMAC_0_EMAC_P1588_RX_SEQUENCE_ID_ADDR A:0x67c5c04c
y.create.l HWIO_EMAC_0_EMAC_P1588_RX_SRC_PORT_ID_5_ADDR A:0x67c5c050
y.create.l HWIO_EMAC_0_EMAC_P1588_RX_SRC_PORT_ID_4_ADDR A:0x67c5c054
y.create.l HWIO_EMAC_0_EMAC_P1588_RX_SRC_PORT_ID_3_ADDR A:0x67c5c058
y.create.l HWIO_EMAC_0_EMAC_P1588_RX_SRC_PORT_ID_2_ADDR A:0x67c5c05c
y.create.l HWIO_EMAC_0_EMAC_P1588_RX_SRC_PORT_ID_1_ADDR A:0x67c5c060
y.create.l HWIO_EMAC_0_EMAC_P1588_RX_TIME_STAMP_5_ADDR A:0x67c5c064
y.create.l HWIO_EMAC_0_EMAC_P1588_RX_TIME_STAMP_4_ADDR A:0x67c5c068
y.create.l HWIO_EMAC_0_EMAC_P1588_RX_TIME_STAMP_3_ADDR A:0x67c5c06c
y.create.l HWIO_EMAC_0_EMAC_P1588_RX_TIME_STAMP_2_ADDR A:0x67c5c070
y.create.l HWIO_EMAC_0_EMAC_P1588_RX_TIME_STAMP_1_ADDR A:0x67c5c074
y.create.l HWIO_EMAC_0_EMAC_P1588_RX_TIME_STAMP_6_ADDR A:0x67c5c078
y.create.l HWIO_EMAC_0_EMAC_P1588_RX_FRAC_NANO_ADDR A:0x67c5c07c
y.create.l HWIO_EMAC_0_EMAC_P1588_TX_SEQUENCE_ID_ADDR A:0x67c5c080
y.create.l HWIO_EMAC_0_EMAC_P1588_TX_SRC_PORT_ID_5_ADDR A:0x67c5c084
y.create.l HWIO_EMAC_0_EMAC_P1588_TX_SRC_PORT_ID_4_ADDR A:0x67c5c088
y.create.l HWIO_EMAC_0_EMAC_P1588_TX_SRC_PORT_ID_3_ADDR A:0x67c5c08c
y.create.l HWIO_EMAC_0_EMAC_P1588_TX_SRC_PORT_ID_2_ADDR A:0x67c5c090
y.create.l HWIO_EMAC_0_EMAC_P1588_TX_SRC_PORT_ID_1_ADDR A:0x67c5c094
y.create.l HWIO_EMAC_0_EMAC_P1588_TX_TIME_STAMP_5_ADDR A:0x67c5c098
y.create.l HWIO_EMAC_0_EMAC_P1588_TX_TIME_STAMP_4_ADDR A:0x67c5c09c
y.create.l HWIO_EMAC_0_EMAC_P1588_TX_TIME_STAMP_3_ADDR A:0x67c5c0a0
y.create.l HWIO_EMAC_0_EMAC_P1588_TX_TIME_STAMP_2_ADDR A:0x67c5c0a4
y.create.l HWIO_EMAC_0_EMAC_P1588_TX_TIME_STAMP_1_ADDR A:0x67c5c0a8
y.create.l HWIO_EMAC_0_EMAC_P1588_TX_TIME_STAMP_6_ADDR A:0x67c5c0ac
y.create.l HWIO_EMAC_0_EMAC_P1588_TX_FRAC_NANO_ADDR A:0x67c5c0b0
y.create.l HWIO_EMAC_0_EMAC_P1588_TX_ORIGIN_CORRECTION_4_ADDR A:0x67c5c0b4
y.create.l HWIO_EMAC_0_EMAC_P1588_TX_ORIGIN_CORRECTION_3_ADDR A:0x67c5c0b8
y.create.l HWIO_EMAC_0_EMAC_P1588_TX_ORIGIN_CORRECTION_2_ADDR A:0x67c5c0bc
y.create.l HWIO_EMAC_0_EMAC_P1588_TX_ORIGIN_CORRECTION_1_ADDR A:0x67c5c0c0
y.create.l HWIO_EMAC_0_EMAC_P1588_TX_INGRESS_TRIG_TIME_4_ADDR A:0x67c5c0c4
y.create.l HWIO_EMAC_0_EMAC_P1588_TX_INGRESS_TRIG_TIME_3_ADDR A:0x67c5c0c8
y.create.l HWIO_EMAC_0_EMAC_P1588_TX_INGRESS_TRIG_TIME_2_ADDR A:0x67c5c0cc
y.create.l HWIO_EMAC_0_EMAC_P1588_TX_INGRESS_TRIG_TIME_1_ADDR A:0x67c5c0d0
y.create.l HWIO_EMAC_0_EMAC_P1588_TX_LATENCY_ADDR A:0x67c5c0d4
y.create.l HWIO_EMAC_0_EMAC_P1588_INC_VALUE_2_ADDR A:0x67c5c0d8
y.create.l HWIO_EMAC_0_EMAC_P1588_INC_VALUE_1_ADDR A:0x67c5c0dc
y.create.l HWIO_EMAC_0_EMAC_P1588_NANO_OFFSET_2_ADDR A:0x67c5c0e0
y.create.l HWIO_EMAC_0_EMAC_P1588_NANO_OFFSET_1_ADDR A:0x67c5c0e4
y.create.l HWIO_EMAC_0_EMAC_P1588_SEC_OFFSET_3_ADDR A:0x67c5c0e8
y.create.l HWIO_EMAC_0_EMAC_P1588_SEC_OFFSET_2_ADDR A:0x67c5c0ec
y.create.l HWIO_EMAC_0_EMAC_P1588_SEC_OFFSET_1_ADDR A:0x67c5c0f0
y.create.l HWIO_EMAC_0_EMAC_P1588_REAL_TIME_5_ADDR A:0x67c5c0f4
y.create.l HWIO_EMAC_0_EMAC_P1588_REAL_TIME_4_ADDR A:0x67c5c0f8
y.create.l HWIO_EMAC_0_EMAC_P1588_REAL_TIME_3_ADDR A:0x67c5c0fc
y.create.l HWIO_EMAC_0_EMAC_P1588_REAL_TIME_2_ADDR A:0x67c5c100
y.create.l HWIO_EMAC_0_EMAC_P1588_REAL_TIME_1_ADDR A:0x67c5c104
y.create.l HWIO_EMAC_0_EMAC_P1588_RFC_FRAC_NANO_2_ADDR A:0x67c5c108
y.create.l HWIO_EMAC_0_EMAC_P1588_RFC_FRAC_NANO_1_ADDR A:0x67c5c10c
y.create.l HWIO_EMAC_0_EMAC_P1588_ADJUST_RTC_ADDR A:0x67c5c110
y.create.l HWIO_EMAC_0_EMAC_P1588_MISC_CONFIG_ADDR A:0x67c5c3c0
y.create.l HWIO_EMAC_0_EMAC_P1588_PTP_EXPANDED_INT_MASK_ADDR A:0x67c5c3c4
y.create.l HWIO_EMAC_0_EMAC_P1588_PTP_EXPANDED_INT_STATUS_ADDR A:0x67c5c3c8
y.create.l HWIO_EMAC_0_EMAC_P1588_LINK_DELAY_2_ADDR A:0x67c5c3cc
y.create.l HWIO_EMAC_0_EMAC_P1588_LINK_DELAY_1_ADDR A:0x67c5c3d0
y.create.l HWIO_EMAC_0_EMAC_P1588_RTC_EXPANDED_CONFIG_ADDR A:0x67c5c400
y.create.l HWIO_EMAC_0_EMAC_P1588_RTC_PRELOADED_5_ADDR A:0x67c5c404
y.create.l HWIO_EMAC_0_EMAC_P1588_RTC_PRELOADED_4_ADDR A:0x67c5c408
y.create.l HWIO_EMAC_0_EMAC_P1588_RTC_PRELOADED_3_ADDR A:0x67c5c40c
y.create.l HWIO_EMAC_0_EMAC_P1588_RTC_PRELOADED_2_ADDR A:0x67c5c410
y.create.l HWIO_EMAC_0_EMAC_P1588_RTC_PRELOADED_1_ADDR A:0x67c5c414
y.create.l HWIO_EMAC_0_EMAC_P1588_GRAND_MASTER_CONFIG_0_ADDR A:0x67c5c800
y.create.l HWIO_EMAC_0_EMAC_P1588_GRAND_MASTER_CONFIG_1_ADDR A:0x67c5c804
y.create.l HWIO_EMAC_0_EMAC_P1588_GM_PPS_TIMESTAMP_5_ADDR A:0x67c5c808
y.create.l HWIO_EMAC_0_EMAC_P1588_GM_PPS_TIMESTAMP_4_ADDR A:0x67c5c80c
y.create.l HWIO_EMAC_0_EMAC_P1588_GM_PPS_TIMESTAMP_3_ADDR A:0x67c5c810
y.create.l HWIO_EMAC_0_EMAC_P1588_GM_PPS_TIMESTAMP_2_ADDR A:0x67c5c814
y.create.l HWIO_EMAC_0_EMAC_P1588_GM_PPS_TIMESTAMP_1_ADDR A:0x67c5c818
y.create.l HWIO_EMAC_0_EMAC_P1588_CURRENT_INC_VALUE_2_ADDR A:0x67c5c81c
y.create.l HWIO_EMAC_0_EMAC_P1588_CURRENT_INC_VALUE_1_ADDR A:0x67c5c820
y.create.l HWIO_EMAC_0_EMAC_P1588_PPSIN_LATENCY_ADDR A:0x67c5c824
y.create.l HWIO_EMAC_0_EMAC_P1588_PHASE_ADJUST_2_ADDR A:0x67c5cc00
y.create.l HWIO_EMAC_0_EMAC_P1588_PHASE_ADJUST_1_ADDR A:0x67c5cc04
y.create.l HWIO_EMAC_0_EMAC_P1588_PPS_PUL_WIDTH_HIGH_ADDR A:0x67c5cc0c
y.create.l HWIO_EMAC_0_EMAC_P1588_PPS_PUL_WIDTH_LOW_ADDR A:0x67c5cc10
y.create.l HWIO_EMAC_0_EMAC_P1588_WAVE_PERIOD_3_ADDR A:0x67c5cc14
y.create.l HWIO_EMAC_0_EMAC_P1588_WAVE_PERIOD_2_ADDR A:0x67c5cc18
y.create.l HWIO_EMAC_0_EMAC_P1588_WAVE_PERIOD_1_ADDR A:0x67c5cc1c
y.create.l HWIO_EMAC_0_EMAC_P1588_TRIG0_CONFIG_ADDR A:0x67c5d000
y.create.l HWIO_EMAC_0_EMAC_P1588_TRIG0_STATUS_ADDR A:0x67c5d004
y.create.l HWIO_EMAC_0_EMAC_P1588_TRIG1_CONFIG_ADDR A:0x67c5d008
y.create.l HWIO_EMAC_0_EMAC_P1588_TRIG1_STATUS_ADDR A:0x67c5d00c
y.create.l HWIO_EMAC_0_EMAC_P1588_TRIG0_TIME_5_ADDR A:0x67c5d010
y.create.l HWIO_EMAC_0_EMAC_P1588_TRIG0_TIME_4_ADDR A:0x67c5d014
y.create.l HWIO_EMAC_0_EMAC_P1588_TRIG0_TIME_3_ADDR A:0x67c5d018
y.create.l HWIO_EMAC_0_EMAC_P1588_TRIG0_TIME_2_ADDR A:0x67c5d01c
y.create.l HWIO_EMAC_0_EMAC_P1588_TRIG0_TIME_1_ADDR A:0x67c5d020
y.create.l HWIO_EMAC_0_EMAC_P1588_TRIG1_TIME_5_ADDR A:0x67c5d024
y.create.l HWIO_EMAC_0_EMAC_P1588_TRIG1_TIME_4_ADDR A:0x67c5d028
y.create.l HWIO_EMAC_0_EMAC_P1588_TRIG1_TIME_3_ADDR A:0x67c5d02c
y.create.l HWIO_EMAC_0_EMAC_P1588_TRIG1_TIME_2_ADDR A:0x67c5d030
y.create.l HWIO_EMAC_0_EMAC_P1588_TRIG1_TIME_1_ADDR A:0x67c5d034
y.create.l HWIO_EMAC_0_EMAC_P1588_EVENT0_CONFIG_ADDR A:0x67c5d038
y.create.l HWIO_EMAC_0_EMAC_P1588_EVENT0_STATUS_ADDR A:0x67c5d03c
y.create.l HWIO_EMAC_0_EMAC_P1588_EVENT1_CONFIG_ADDR A:0x67c5d040
y.create.l HWIO_EMAC_0_EMAC_P1588_EVENT1_STATUS_ADDR A:0x67c5d044
y.create.l HWIO_EMAC_0_EMAC_P1588_EVENT0_TIMESTAMP_5_ADDR A:0x67c5d048
y.create.l HWIO_EMAC_0_EMAC_P1588_EVENT0_TIMESTAMP_4_ADDR A:0x67c5d04c
y.create.l HWIO_EMAC_0_EMAC_P1588_EVENT0_TIMESTAMP_3_ADDR A:0x67c5d050
y.create.l HWIO_EMAC_0_EMAC_P1588_EVENT0_TIMESTAMP_2_ADDR A:0x67c5d054
y.create.l HWIO_EMAC_0_EMAC_P1588_EVENT0_TIMESTAMP_1_ADDR A:0x67c5d058
y.create.l HWIO_EMAC_0_EMAC_P1588_EVENT1_TIMESTAMP_5_ADDR A:0x67c5d05c
y.create.l HWIO_EMAC_0_EMAC_P1588_EVENT1_TIMESTAMP_4_ADDR A:0x67c5d060
y.create.l HWIO_EMAC_0_EMAC_P1588_EVENT1_TIMESTAMP_3_ADDR A:0x67c5d064
y.create.l HWIO_EMAC_0_EMAC_P1588_EVENT1_TIMESTAMP_2_ADDR A:0x67c5d068
y.create.l HWIO_EMAC_0_EMAC_P1588_EVENT1_TIMESTAMP_1_ADDR A:0x67c5d06c
y.create.l HWIO_EMAC_0_EMAC_P1588_RX_SEQUENCE_ID_PRE_ADDR A:0x67c5d400
y.create.l HWIO_EMAC_0_EMAC_P1588_RX_SRC_PORT_ID_PRE_5_ADDR A:0x67c5d404
y.create.l HWIO_EMAC_0_EMAC_P1588_RX_SRC_PORT_ID_PRE_4_ADDR A:0x67c5d408
y.create.l HWIO_EMAC_0_EMAC_P1588_RX_SRC_PORT_ID_PRE_3_ADDR A:0x67c5d40c
y.create.l HWIO_EMAC_0_EMAC_P1588_RX_SRC_PORT_ID_PRE_2_ADDR A:0x67c5d410
y.create.l HWIO_EMAC_0_EMAC_P1588_RX_SRC_PORT_ID_PRE_1_ADDR A:0x67c5d414
y.create.l HWIO_EMAC_0_EMAC_P1588_RX_TIMESTAMP_PRE_5_ADDR A:0x67c5d418
y.create.l HWIO_EMAC_0_EMAC_P1588_RX_TIMESTAMP_PRE_4_ADDR A:0x67c5d41c
y.create.l HWIO_EMAC_0_EMAC_P1588_RX_TIMESTAMP_PRE_3_ADDR A:0x67c5d420
y.create.l HWIO_EMAC_0_EMAC_P1588_RX_TIMESTAMP_PRE_2_ADDR A:0x67c5d424
y.create.l HWIO_EMAC_0_EMAC_P1588_RX_TIMESTAMP_PRE_1_ADDR A:0x67c5d428
y.create.l HWIO_EMAC_0_EMAC_P1588_RX_TIMESTAMP_PRE_6_ADDR A:0x67c5d42c
y.create.l HWIO_EMAC_0_EMAC_P1588_RX_FRAC_NANO_PRE_1_ADDR A:0x67c5d430
y.create.l HWIO_EMAC_0_EMAC_P1588_RX_SEQUENCE_ID_PRE2_ADDR A:0x67c5d468
y.create.l HWIO_EMAC_0_EMAC_P1588_RX_SRC_PORT_ID_PRE2_5_ADDR A:0x67c5d46c
y.create.l HWIO_EMAC_0_EMAC_P1588_RX_SRC_PORT_ID_PRE2_4_ADDR A:0x67c5d470
y.create.l HWIO_EMAC_0_EMAC_P1588_RX_SRC_PORT_ID_PRE2_3_ADDR A:0x67c5d474
y.create.l HWIO_EMAC_0_EMAC_P1588_RX_SRC_PORT_ID_PRE2_2_ADDR A:0x67c5d478
y.create.l HWIO_EMAC_0_EMAC_P1588_RX_SRC_PORT_ID_PRE2_1_ADDR A:0x67c5d47c
y.create.l HWIO_EMAC_0_EMAC_P1588_RX_TIMESTAMP_PRE2_5_ADDR A:0x67c5d480
y.create.l HWIO_EMAC_0_EMAC_P1588_RX_TIMESTAMP_PRE2_4_ADDR A:0x67c5d484
y.create.l HWIO_EMAC_0_EMAC_P1588_RX_TIMESTAMP_PRE2_3_ADDR A:0x67c5d488
y.create.l HWIO_EMAC_0_EMAC_P1588_RX_TIMESTAMP_PRE2_2_ADDR A:0x67c5d48c
y.create.l HWIO_EMAC_0_EMAC_P1588_RX_TIMESTAMP_PRE2_1_ADDR A:0x67c5d490
y.create.l HWIO_EMAC_0_EMAC_P1588_RX_TIMESTAMP_PRE2_6_ADDR A:0x67c5d494
y.create.l HWIO_EMAC_0_EMAC_P1588_RX_FRAC_NANO_PRE2_1_ADDR A:0x67c5d498
y.create.l HWIO_EMAC_0_EMAC_P1588_RX_SEQUENCE_ID_PRE3_ADDR A:0x67c5d4d0
y.create.l HWIO_EMAC_0_EMAC_P1588_RX_SRC_PORT_ID_PRE3_5_ADDR A:0x67c5d4d4
y.create.l HWIO_EMAC_0_EMAC_P1588_RX_SRC_PORT_ID_PRE3_4_ADDR A:0x67c5d4d8
y.create.l HWIO_EMAC_0_EMAC_P1588_RX_SRC_PORT_ID_PRE3_3_ADDR A:0x67c5d4dc
y.create.l HWIO_EMAC_0_EMAC_P1588_RX_SRC_PORT_ID_PRE3_2_ADDR A:0x67c5d4e0
y.create.l HWIO_EMAC_0_EMAC_P1588_RX_SRC_PORT_ID_PRE3_1_ADDR A:0x67c5d4e4
y.create.l HWIO_EMAC_0_EMAC_P1588_RX_TIMESTAMP_PRE3_5_ADDR A:0x67c5d4e8
y.create.l HWIO_EMAC_0_EMAC_P1588_RX_TIMESTAMP_PRE3_4_ADDR A:0x67c5d4ec
y.create.l HWIO_EMAC_0_EMAC_P1588_RX_TIMESTAMP_PRE3_3_ADDR A:0x67c5d4f0
y.create.l HWIO_EMAC_0_EMAC_P1588_RX_TIMESTAMP_PRE3_2_ADDR A:0x67c5d4f4
y.create.l HWIO_EMAC_0_EMAC_P1588_RX_TIMESTAMP_PRE3_1_ADDR A:0x67c5d4f8
y.create.l HWIO_EMAC_0_EMAC_P1588_RX_TIMESTAMP_PRE3_6_ADDR A:0x67c5d4fc
y.create.l HWIO_EMAC_0_EMAC_P1588_RX_FRAC_NANO_PRE3_1_ADDR A:0x67c5d500
y.create.l HWIO_EMAC_0_EMAC_P1588_RX_COM_TS_CTRL_ADDR A:0x67c5d800
y.create.l HWIO_EMAC_0_EMAC_P1588_RX_FILT_MAC_DA_3_ADDR A:0x67c5d804
y.create.l HWIO_EMAC_0_EMAC_P1588_RX_FILT_MAC_DA_2_ADDR A:0x67c5d808
y.create.l HWIO_EMAC_0_EMAC_P1588_RX_FILT_MAC_DA_1_ADDR A:0x67c5d80c
y.create.l HWIO_EMAC_0_EMAC_P1588_RX_FILT_IPV4_DA_2_ADDR A:0x67c5d810
y.create.l HWIO_EMAC_0_EMAC_P1588_RX_FILT_IPV4_DA_1_ADDR A:0x67c5d814
y.create.l HWIO_EMAC_0_EMAC_P1588_RX_FILT_IPV6_DA_8_ADDR A:0x67c5d818
y.create.l HWIO_EMAC_0_EMAC_P1588_RX_FILT_IPV6_DA_7_ADDR A:0x67c5d81c
y.create.l HWIO_EMAC_0_EMAC_P1588_RX_FILT_IPV6_DA_6_ADDR A:0x67c5d820
y.create.l HWIO_EMAC_0_EMAC_P1588_RX_FILT_IPV6_DA_5_ADDR A:0x67c5d824
y.create.l HWIO_EMAC_0_EMAC_P1588_RX_FILT_IPV6_DA_4_ADDR A:0x67c5d828
y.create.l HWIO_EMAC_0_EMAC_P1588_RX_FILT_IPV6_DA_3_ADDR A:0x67c5d82c
y.create.l HWIO_EMAC_0_EMAC_P1588_RX_FILT_IPV6_DA_2_ADDR A:0x67c5d830
y.create.l HWIO_EMAC_0_EMAC_P1588_RX_FILT_IPV6_DA_1_ADDR A:0x67c5d834
y.create.l HWIO_EMAC_0_EMAC_P1588_RX_FILT_MAC_LENGTHTYPE_ADDR A:0x67c5d838
y.create.l HWIO_EMAC_0_EMAC_P1588_RX_FILT_LAYER4_PROTOCOL_ADDR A:0x67c5d83c
y.create.l HWIO_EMAC_0_EMAC_P1588_RX_FILT_UDP_PORT_ADDR A:0x67c5d840
y.create.l HWIO_EMAC_0_EMAC_P1588_RX_COM_TS_STATUS_ADDR A:0x67c5d844
y.create.l HWIO_EMAC_0_EMAC_P1588_RX_COM_TIMESTAMP_5_ADDR A:0x67c5d848
y.create.l HWIO_EMAC_0_EMAC_P1588_RX_COM_TIMESTAMP_4_ADDR A:0x67c5d84c
y.create.l HWIO_EMAC_0_EMAC_P1588_RX_COM_TIMESTAMP_3_ADDR A:0x67c5d850
y.create.l HWIO_EMAC_0_EMAC_P1588_RX_COM_TIMESTAMP_2_ADDR A:0x67c5d854
y.create.l HWIO_EMAC_0_EMAC_P1588_RX_COM_TIMESTAMP_1_ADDR A:0x67c5d858
y.create.l HWIO_EMAC_0_EMAC_P1588_RX_COM_FRAC_NANO_ADDR A:0x67c5d85c
y.create.l HWIO_EMAC_0_EMAC_P1588_RX_COM_TIMESTAMP_PRE_5_ADDR A:0x67c5d860
y.create.l HWIO_EMAC_0_EMAC_P1588_RX_COM_TIMESTAMP_PRE_4_ADDR A:0x67c5d864
y.create.l HWIO_EMAC_0_EMAC_P1588_RX_COM_TIMESTAMP_PRE_3_ADDR A:0x67c5d868
y.create.l HWIO_EMAC_0_EMAC_P1588_RX_COM_TIMESTAMP_PRE_2_ADDR A:0x67c5d86c
y.create.l HWIO_EMAC_0_EMAC_P1588_RX_COM_TIMESTAMP_PRE_1_ADDR A:0x67c5d870
y.create.l HWIO_EMAC_0_EMAC_P1588_RX_COM_FRAC_NANO_PRE_ADDR A:0x67c5d874
y.create.l HWIO_EMAC_0_EMAC_P1588_RX_Y1731_IDENTITY_ADDR A:0x67c5d878
y.create.l HWIO_EMAC_0_EMAC_P1588_RX_Y1731_IDENTITY_PRE_ADDR A:0x67c5d87c
y.create.l HWIO_EMAC_0_EMAC_P1588_TX_COM_TS_CTRL_ADDR A:0x67c5d880
y.create.l HWIO_EMAC_0_EMAC_P1588_TX_FILT_MAC_DA_3_ADDR A:0x67c5d884
y.create.l HWIO_EMAC_0_EMAC_P1588_TX_FILT_MAC_DA_2_ADDR A:0x67c5d888
y.create.l HWIO_EMAC_0_EMAC_P1588_TX_FILT_MAC_DA_1_ADDR A:0x67c5d88c
y.create.l HWIO_EMAC_0_EMAC_P1588_TX_FILT_IPV4_DA_2_ADDR A:0x67c5d890
y.create.l HWIO_EMAC_0_EMAC_P1588_TX_FILT_IPV4_DA_1_ADDR A:0x67c5d894
y.create.l HWIO_EMAC_0_EMAC_P1588_TX_FILT_IPV6_DA_8_ADDR A:0x67c5d898
y.create.l HWIO_EMAC_0_EMAC_P1588_TX_FILT_IPV6_DA_7_ADDR A:0x67c5d89c
y.create.l HWIO_EMAC_0_EMAC_P1588_TX_FILT_IPV6_DA_6_ADDR A:0x67c5d8a0
y.create.l HWIO_EMAC_0_EMAC_P1588_TX_FILT_IPV6_DA_5_ADDR A:0x67c5d8a4
y.create.l HWIO_EMAC_0_EMAC_P1588_TX_FILT_IPV6_DA_4_ADDR A:0x67c5d8a8
y.create.l HWIO_EMAC_0_EMAC_P1588_TX_FILT_IPV6_DA_3_ADDR A:0x67c5d8ac
y.create.l HWIO_EMAC_0_EMAC_P1588_TX_FILT_IPV6_DA_2_ADDR A:0x67c5d8b0
y.create.l HWIO_EMAC_0_EMAC_P1588_TX_FILT_IPV6_DA_1_ADDR A:0x67c5d8b4
y.create.l HWIO_EMAC_0_EMAC_P1588_TX_FILT_MAC_LENGTHTYPE_ADDR A:0x67c5d8b8
y.create.l HWIO_EMAC_0_EMAC_P1588_TX_FILT_LAYER4_PROTOCOL_ADDR A:0x67c5d8bc
y.create.l HWIO_EMAC_0_EMAC_P1588_TX_FILT_UDP_PORT_ADDR A:0x67c5d8c0
y.create.l HWIO_EMAC_0_EMAC_P1588_TX_COM_TS_STATUS_ADDR A:0x67c5d8c4
y.create.l HWIO_EMAC_0_EMAC_P1588_TX_COM_TIMESTAMP_5_ADDR A:0x67c5d8c8
y.create.l HWIO_EMAC_0_EMAC_P1588_TX_COM_TIMESTAMP_4_ADDR A:0x67c5d8cc
y.create.l HWIO_EMAC_0_EMAC_P1588_TX_COM_TIMESTAMP_3_ADDR A:0x67c5d8d0
y.create.l HWIO_EMAC_0_EMAC_P1588_TX_COM_TIMESTAMP_2_ADDR A:0x67c5d8d4
y.create.l HWIO_EMAC_0_EMAC_P1588_TX_COM_TIMESTAMP_1_ADDR A:0x67c5d8d8
y.create.l HWIO_EMAC_0_EMAC_P1588_TX_COM_FRAC_NANO_ADDR A:0x67c5d8dc
y.create.l HWIO_EMAC_0_EMAC_P1588_TX_Y1731_IDENTITY_ADDR A:0x67c5d8f8
y.create.l HWIO_EMAC_0_EMAC_P1588_Y1731_DM_CONTROL_ADDR A:0x67c5d900
y.create.l HWIO_EMAC_0_EMAC_P1588_LOC_MAC_ADDR_O_3_ADDR A:0x67c5c128
y.create.l HWIO_EMAC_0_EMAC_P1588_LOC_MAC_ADDR_O_2_ADDR A:0x67c5c12c
y.create.l HWIO_EMAC_0_EMAC_P1588_LOC_MAC_ADDR_O_1_ADDR A:0x67c5c130
y.create.l HWIO_EMAC_0_EMAC_P1588_BAUD_CONFIG_ADDR A:0x67c5dc00
y.create.l HWIO_EMAC_0_EMAC_P1588_UART_CONFIGURATION_ADDR A:0x67c5dc04
y.create.l HWIO_EMAC_0_EMAC_P1588_RESET_UART_BUFFER_ADDR A:0x67c5dc08
y.create.l HWIO_EMAC_0_EMAC_P1588_UART_BUFFER_RX_TX_STATUS_ADDR A:0x67c5dc0c
y.create.l HWIO_EMAC_0_EMAC_P1588_TX_BUFFER_WRITE_ADDR A:0x67c5dc10
y.create.l HWIO_EMAC_0_EMAC_P1588_RX_BUFFER_READ_ADDR A:0x67c5dc14
y.create.l HWIO_EMAC_0_EMAC_XPU_SCR_ADDR A:0x67c50000
y.create.l HWIO_EMAC_0_EMAC_XPU_SWDR_ADDR A:0x67c50004
y.create.l HWIO_EMAC_0_EMAC_XPU_SEAR0_ADDR A:0x67c50040
y.create.l HWIO_EMAC_0_EMAC_XPU_SESR_ADDR A:0x67c50048
y.create.l HWIO_EMAC_0_EMAC_XPU_SESRRESTORE_ADDR A:0x67c5004c
y.create.l HWIO_EMAC_0_EMAC_XPU_SESYNR0_ADDR A:0x67c50050
y.create.l HWIO_EMAC_0_EMAC_XPU_SESYNR1_ADDR A:0x67c50054
y.create.l HWIO_EMAC_0_EMAC_XPU_SESYNR2_ADDR A:0x67c50058
y.create.l HWIO_EMAC_0_EMAC_XPU_MCR_ADDR A:0x67c50100
y.create.l HWIO_EMAC_0_EMAC_XPU_MEAR0_ADDR A:0x67c50140
y.create.l HWIO_EMAC_0_EMAC_XPU_MESR_ADDR A:0x67c50148
y.create.l HWIO_EMAC_0_EMAC_XPU_MESRRESTORE_ADDR A:0x67c5014c
y.create.l HWIO_EMAC_0_EMAC_XPU_MESYNR0_ADDR A:0x67c50150
y.create.l HWIO_EMAC_0_EMAC_XPU_MESYNR1_ADDR A:0x67c50154
y.create.l HWIO_EMAC_0_EMAC_XPU_MESYNR2_ADDR A:0x67c50158
y.create.l HWIO_EMAC_0_EMAC_XPU_CR_ADDR A:0x67c50080
y.create.l HWIO_EMAC_0_EMAC_XPU_RPU_ACR0_ADDR A:0x67c500a0
y.create.l HWIO_EMAC_0_EMAC_XPU_EAR0_ADDR A:0x67c500c0
y.create.l HWIO_EMAC_0_EMAC_XPU_ESR_ADDR A:0x67c500c8
y.create.l HWIO_EMAC_0_EMAC_XPU_ESRRESTORE_ADDR A:0x67c500cc
y.create.l HWIO_EMAC_0_EMAC_XPU_ESYNR0_ADDR A:0x67c500d0
y.create.l HWIO_EMAC_0_EMAC_XPU_ESYNR1_ADDR A:0x67c500d4
y.create.l HWIO_EMAC_0_EMAC_XPU_ESYNR2_ADDR A:0x67c500d8
y.create.l HWIO_EMAC_0_EMAC_XPU_IDR0_ADDR A:0x67c50074
y.create.l HWIO_EMAC_0_EMAC_XPU_IDR1_ADDR A:0x67c50078
y.create.l HWIO_EMAC_0_EMAC_XPU_REV_ADDR A:0x67c5007c
y.create.l HWIO_EMAC_0_EMAC_XPU_RG0_RACR0_ADDR A:0x67c50200
y.create.l HWIO_EMAC_0_EMAC_XPU_RG0_SCR_ADDR A:0x67c50250
y.create.l HWIO_EMAC_0_EMAC_XPU_RG0_MCR_ADDR A:0x67c50254
y.create.l HWIO_EMAC_0_EMAC_VMIDMT_SCR0_ADDR A:0x67c54000
y.create.l HWIO_EMAC_0_EMAC_VMIDMT_SCR1_ADDR A:0x67c54004
y.create.l HWIO_EMAC_0_EMAC_VMIDMT_SCR2_ADDR A:0x67c54008
y.create.l HWIO_EMAC_0_EMAC_VMIDMT_SACR_ADDR A:0x67c54010
y.create.l HWIO_EMAC_0_EMAC_VMIDMT_SIDR0_ADDR A:0x67c54020
y.create.l HWIO_EMAC_0_EMAC_VMIDMT_SIDR1_ADDR A:0x67c54024
y.create.l HWIO_EMAC_0_EMAC_VMIDMT_SIDR2_ADDR A:0x67c54028
y.create.l HWIO_EMAC_0_EMAC_VMIDMT_SIDR4_ADDR A:0x67c54030
y.create.l HWIO_EMAC_0_EMAC_VMIDMT_SIDR5_ADDR A:0x67c54034
y.create.l HWIO_EMAC_0_EMAC_VMIDMT_SIDR7_ADDR A:0x67c5403c
y.create.l HWIO_EMAC_0_EMAC_VMIDMT_SGFAR0_ADDR A:0x67c54040
y.create.l HWIO_EMAC_0_EMAC_VMIDMT_SGFSR_ADDR A:0x67c54048
y.create.l HWIO_EMAC_0_EMAC_VMIDMT_SGFSRRESTORE_ADDR A:0x67c5404c
y.create.l HWIO_EMAC_0_EMAC_VMIDMT_SGFSYNDR0_ADDR A:0x67c54050
y.create.l HWIO_EMAC_0_EMAC_VMIDMT_SGFSYNDR1_ADDR A:0x67c54054
y.create.l HWIO_EMAC_0_EMAC_VMIDMT_SGFSYNDR2_ADDR A:0x67c54058
y.create.l HWIO_EMAC_0_EMAC_VMIDMT_VMIDMTSCR0_ADDR A:0x67c54090
y.create.l HWIO_EMAC_0_EMAC_VMIDMT_CR0_ADDR A:0x67c54000
y.create.l HWIO_EMAC_0_EMAC_VMIDMT_CR2_ADDR A:0x67c54008
y.create.l HWIO_EMAC_0_EMAC_VMIDMT_ACR_ADDR A:0x67c54010
y.create.l HWIO_EMAC_0_EMAC_VMIDMT_IDR0_ADDR A:0x67c54020
y.create.l HWIO_EMAC_0_EMAC_VMIDMT_IDR1_ADDR A:0x67c54024
y.create.l HWIO_EMAC_0_EMAC_VMIDMT_IDR2_ADDR A:0x67c54028
y.create.l HWIO_EMAC_0_EMAC_VMIDMT_IDR4_ADDR A:0x67c54030
y.create.l HWIO_EMAC_0_EMAC_VMIDMT_IDR5_ADDR A:0x67c54034
y.create.l HWIO_EMAC_0_EMAC_VMIDMT_IDR7_ADDR A:0x67c5403c
y.create.l HWIO_EMAC_0_EMAC_VMIDMT_GFAR0_ADDR A:0x67c54040
y.create.l HWIO_EMAC_0_EMAC_VMIDMT_GFSR_ADDR A:0x67c54048
y.create.l HWIO_EMAC_0_EMAC_VMIDMT_GFSRRESTORE_ADDR A:0x67c5404c
y.create.l HWIO_EMAC_0_EMAC_VMIDMT_GFSYNDR0_ADDR A:0x67c54050
y.create.l HWIO_EMAC_0_EMAC_VMIDMT_GFSYNDR1_ADDR A:0x67c54054
y.create.l HWIO_EMAC_0_EMAC_VMIDMT_GFSYNDR2_ADDR A:0x67c54058
y.create.l HWIO_EMAC_0_EMAC_VMIDMT_VMIDMTCR0_ADDR A:0x67c54090
y.create.l HWIO_EMAC_0_EMAC_VMIDMT_VMIDMTACR_ADDR A:0x67c5409c
y.create.l HWIO_EMAC_0_EMAC_VMIDMT_NSCR0_ADDR A:0x67c54400
y.create.l HWIO_EMAC_0_EMAC_VMIDMT_NSCR2_ADDR A:0x67c54408
y.create.l HWIO_EMAC_0_EMAC_VMIDMT_NSACR_ADDR A:0x67c54410
y.create.l HWIO_EMAC_0_EMAC_VMIDMT_NSGFAR0_ADDR A:0x67c54440
y.create.l HWIO_EMAC_0_EMAC_VMIDMT_NSGFSR_ADDR A:0x67c54448
y.create.l HWIO_EMAC_0_EMAC_VMIDMT_NSGFSRRESTORE_ADDR A:0x67c5444c
y.create.l HWIO_EMAC_0_EMAC_VMIDMT_NSGFSYNDR0_ADDR A:0x67c54450
y.create.l HWIO_EMAC_0_EMAC_VMIDMT_NSGFSYNDR1_ADDR A:0x67c54454
y.create.l HWIO_EMAC_0_EMAC_VMIDMT_NSGFSYNDR2_ADDR A:0x67c54458
y.create.l HWIO_EMAC_0_EMAC_VMIDMT_NSVMIDMTCR0_ADDR A:0x67c54490
y.create.l HWIO_EMAC_0_EMAC_VMIDMT_SSDR0_ADDR A:0x67c54080
y.create.l HWIO_EMAC_0_EMAC_VMIDMT_MSDR0_ADDR A:0x67c54480
y.create.l HWIO_EMAC_0_EMAC_VMIDMT_MCR_ADDR A:0x67c54494
y.create.l HWIO_EMAC_0_EMAC_VMIDMT_S2VR0_ADDR A:0x67c54c00
y.create.l HWIO_EMAC_0_EMAC_VMIDMT_AS2VR0_ADDR A:0x67c54e00
y.create.l HWIO_EMAC_0_EMAC_QSERDES_COM_SYS_CLK_CTRL_ADDR A:0x67c58000
y.create.l HWIO_EMAC_0_EMAC_QSERDES_COM_PLL_VCOTAIL_EN_ADDR A:0x67c58004
y.create.l HWIO_EMAC_0_EMAC_QSERDES_COM_CMN_MODE_ADDR A:0x67c58008
y.create.l HWIO_EMAC_0_EMAC_QSERDES_COM_IE_TRIM_ADDR A:0x67c5800c
y.create.l HWIO_EMAC_0_EMAC_QSERDES_COM_IP_TRIM_ADDR A:0x67c58010
y.create.l HWIO_EMAC_0_EMAC_QSERDES_COM_PLL_CNTRL_ADDR A:0x67c58014
y.create.l HWIO_EMAC_0_EMAC_QSERDES_COM_PLL_IP_SETI_ADDR A:0x67c58018
y.create.l HWIO_EMAC_0_EMAC_QSERDES_COM_CORE_CLK_IN_SYNC_SEL_ADDR A:0x67c5801c
y.create.l HWIO_EMAC_0_EMAC_QSERDES_COM_BIAS_EN_CLKBUFLR_EN_ADDR A:0x67c58020
y.create.l HWIO_EMAC_0_EMAC_QSERDES_COM_PLL_CP_SETI_ADDR A:0x67c58024
y.create.l HWIO_EMAC_0_EMAC_QSERDES_COM_PLL_IP_SETP_ADDR A:0x67c58028
y.create.l HWIO_EMAC_0_EMAC_QSERDES_COM_PLL_CP_SETP_ADDR A:0x67c5802c
y.create.l HWIO_EMAC_0_EMAC_QSERDES_COM_ATB_SEL1_ADDR A:0x67c58030
y.create.l HWIO_EMAC_0_EMAC_QSERDES_COM_ATB_SEL2_ADDR A:0x67c58034
y.create.l HWIO_EMAC_0_EMAC_QSERDES_COM_SYSCLK_EN_SEL_ADDR A:0x67c58038
y.create.l HWIO_EMAC_0_EMAC_QSERDES_COM_RES_CODE_TXBAND_ADDR A:0x67c5803c
y.create.l HWIO_EMAC_0_EMAC_QSERDES_COM_RESETSM_CNTRL_ADDR A:0x67c58040
y.create.l HWIO_EMAC_0_EMAC_QSERDES_COM_PLLLOCK_CMP1_ADDR A:0x67c58044
y.create.l HWIO_EMAC_0_EMAC_QSERDES_COM_PLLLOCK_CMP2_ADDR A:0x67c58048
y.create.l HWIO_EMAC_0_EMAC_QSERDES_COM_PLLLOCK_CMP3_ADDR A:0x67c5804c
y.create.l HWIO_EMAC_0_EMAC_QSERDES_COM_PLLLOCK_CMP_EN_ADDR A:0x67c58050
y.create.l HWIO_EMAC_0_EMAC_QSERDES_COM_RES_TRIM_OFFSET_ADDR A:0x67c58054
y.create.l HWIO_EMAC_0_EMAC_QSERDES_COM_BGTC_ADDR A:0x67c58058
y.create.l HWIO_EMAC_0_EMAC_QSERDES_COM_PLL_TEST_UPDN_RESTRIMSTEP_ADDR A:0x67c5805c
y.create.l HWIO_EMAC_0_EMAC_QSERDES_COM_PLL_VCO_TUNE_ADDR A:0x67c58060
y.create.l HWIO_EMAC_0_EMAC_QSERDES_COM_DEC_START1_ADDR A:0x67c58064
y.create.l HWIO_EMAC_0_EMAC_QSERDES_COM_PLL_AMP_OS_ADDR A:0x67c58068
y.create.l HWIO_EMAC_0_EMAC_QSERDES_COM_SSC_EN_CENTER_ADDR A:0x67c5806c
y.create.l HWIO_EMAC_0_EMAC_QSERDES_COM_SSC_ADJ_PER1_ADDR A:0x67c58070
y.create.l HWIO_EMAC_0_EMAC_QSERDES_COM_SSC_ADJ_PER2_ADDR A:0x67c58074
y.create.l HWIO_EMAC_0_EMAC_QSERDES_COM_SSC_PER1_ADDR A:0x67c58078
y.create.l HWIO_EMAC_0_EMAC_QSERDES_COM_SSC_PER2_ADDR A:0x67c5807c
y.create.l HWIO_EMAC_0_EMAC_QSERDES_COM_SSC_STEP_SIZE1_ADDR A:0x67c58080
y.create.l HWIO_EMAC_0_EMAC_QSERDES_COM_SSC_STEP_SIZE2_ADDR A:0x67c58084
y.create.l HWIO_EMAC_0_EMAC_QSERDES_COM_RES_TRIM_SEARCH_ADDR A:0x67c58088
y.create.l HWIO_EMAC_0_EMAC_QSERDES_COM_RES_TRIM_FREEZE_ADDR A:0x67c5808c
y.create.l HWIO_EMAC_0_EMAC_QSERDES_COM_RES_TRIM_EN_VCOCALDONE_ADDR A:0x67c58090
y.create.l HWIO_EMAC_0_EMAC_QSERDES_COM_FAUX_EN_ADDR A:0x67c58094
y.create.l HWIO_EMAC_0_EMAC_QSERDES_COM_DIV_FRAC_START1_ADDR A:0x67c58098
y.create.l HWIO_EMAC_0_EMAC_QSERDES_COM_DIV_FRAC_START2_ADDR A:0x67c5809c
y.create.l HWIO_EMAC_0_EMAC_QSERDES_COM_DIV_FRAC_START3_ADDR A:0x67c580a0
y.create.l HWIO_EMAC_0_EMAC_QSERDES_COM_DEC_START2_ADDR A:0x67c580a4
y.create.l HWIO_EMAC_0_EMAC_QSERDES_COM_PLL_RXTXEPCLK_EN_ADDR A:0x67c580a8
y.create.l HWIO_EMAC_0_EMAC_QSERDES_COM_PLL_CRCTRL_ADDR A:0x67c580ac
y.create.l HWIO_EMAC_0_EMAC_QSERDES_COM_PLL_CLKEPDIV_ADDR A:0x67c580b0
y.create.l HWIO_EMAC_0_EMAC_QSERDES_COM_PLL_FREQUPDATE_ADDR A:0x67c580b4
y.create.l HWIO_EMAC_0_EMAC_QSERDES_COM_PLL_VCO_HIGH_ADDR A:0x67c580b8
y.create.l HWIO_EMAC_0_EMAC_QSERDES_COM_RESET_SM_ADDR A:0x67c580bc
y.create.l HWIO_EMAC_0_EMAC_QSERDES_TX_BIST_MODE_LANENO_ADDR A:0x67c58100
y.create.l HWIO_EMAC_0_EMAC_QSERDES_TX_CLKBUF_ENABLE_ADDR A:0x67c58104
y.create.l HWIO_EMAC_0_EMAC_QSERDES_TX_TX_EMP_POST1_LVL_ADDR A:0x67c58108
y.create.l HWIO_EMAC_0_EMAC_QSERDES_TX_TX_DRV_LVL_ADDR A:0x67c5810c
y.create.l HWIO_EMAC_0_EMAC_QSERDES_TX_RESET_TSYNC_EN_ADDR A:0x67c58110
y.create.l HWIO_EMAC_0_EMAC_QSERDES_TX_LPB_EN_ADDR A:0x67c58114
y.create.l HWIO_EMAC_0_EMAC_QSERDES_TX_RES_CODE_ADDR A:0x67c58118
y.create.l HWIO_EMAC_0_EMAC_QSERDES_TX_PERL_LENGTH1_ADDR A:0x67c5811c
y.create.l HWIO_EMAC_0_EMAC_QSERDES_TX_PERL_LENGTH2_ADDR A:0x67c58120
y.create.l HWIO_EMAC_0_EMAC_QSERDES_TX_SERDES_BYP_EN_OUT_ADDR A:0x67c58124
y.create.l HWIO_EMAC_0_EMAC_QSERDES_TX_HIGHZ_TRANSCEIVEREN_BIAS_EN_ADDR A:0x67c58128
y.create.l HWIO_EMAC_0_EMAC_QSERDES_TX_PARRATE_REC_DETECT_IDLE_EN_ADDR A:0x67c5812c
y.create.l HWIO_EMAC_0_EMAC_QSERDES_TX_BIST_PATTERN1_ADDR A:0x67c58130
y.create.l HWIO_EMAC_0_EMAC_QSERDES_TX_BIST_PATTERN2_ADDR A:0x67c58134
y.create.l HWIO_EMAC_0_EMAC_QSERDES_TX_BIST_PATTERN3_ADDR A:0x67c58138
y.create.l HWIO_EMAC_0_EMAC_QSERDES_TX_BIST_PATTERN4_ADDR A:0x67c5813c
y.create.l HWIO_EMAC_0_EMAC_QSERDES_TX_BIST_PATTERN5_ADDR A:0x67c58140
y.create.l HWIO_EMAC_0_EMAC_QSERDES_TX_BIST_PATTERN6_ADDR A:0x67c58144
y.create.l HWIO_EMAC_0_EMAC_QSERDES_TX_BIST_PATTERN7_ADDR A:0x67c58148
y.create.l HWIO_EMAC_0_EMAC_QSERDES_TX_BIST_PATTERN8_ADDR A:0x67c5814c
y.create.l HWIO_EMAC_0_EMAC_QSERDES_TX_LANE_MODE_ADDR A:0x67c58150
y.create.l HWIO_EMAC_0_EMAC_QSERDES_TX_ATB_SEL_ADDR A:0x67c58154
y.create.l HWIO_EMAC_0_EMAC_QSERDES_TX_REC_DETECT_LVL_ADDR A:0x67c58158
y.create.l HWIO_EMAC_0_EMAC_QSERDES_TX_PRBS_SEED1_ADDR A:0x67c5815c
y.create.l HWIO_EMAC_0_EMAC_QSERDES_TX_PRBS_SEED2_ADDR A:0x67c58160
y.create.l HWIO_EMAC_0_EMAC_QSERDES_TX_PRBS_SEED3_ADDR A:0x67c58164
y.create.l HWIO_EMAC_0_EMAC_QSERDES_TX_PRBS_SEED4_ADDR A:0x67c58168
y.create.l HWIO_EMAC_0_EMAC_QSERDES_TX_RESET_GEN_ADDR A:0x67c5816c
y.create.l HWIO_EMAC_0_EMAC_QSERDES_TX_TRAN_DRVR_EMP_EN_ADDR A:0x67c58170
y.create.l HWIO_EMAC_0_EMAC_QSERDES_TX_TX_INTERFACE_MODE_ADDR A:0x67c58174
y.create.l HWIO_EMAC_0_EMAC_QSERDES_TX_BIST_STATUS_ADDR A:0x67c58178
y.create.l HWIO_EMAC_0_EMAC_QSERDES_TX_BIST_ERROR_COUNT1_ADDR A:0x67c5817c
y.create.l HWIO_EMAC_0_EMAC_QSERDES_TX_BIST_ERROR_COUNT2_ADDR A:0x67c58180
y.create.l HWIO_EMAC_0_EMAC_QSERDES_RX_CDR_CONTROL_ADDR A:0x67c58200
y.create.l HWIO_EMAC_0_EMAC_QSERDES_RX_AUX_CONTROL_ADDR A:0x67c58204
y.create.l HWIO_EMAC_0_EMAC_QSERDES_RX_AUX_DATA_TCODE_ADDR A:0x67c58208
y.create.l HWIO_EMAC_0_EMAC_QSERDES_RX_RCLK_AUXDATA_SEL_ADDR A:0x67c5820c
y.create.l HWIO_EMAC_0_EMAC_QSERDES_RX_CDR_CONTROL2_ADDR A:0x67c58210
y.create.l HWIO_EMAC_0_EMAC_QSERDES_RX_AC_JTAG_INITP_ADDR A:0x67c58214
y.create.l HWIO_EMAC_0_EMAC_QSERDES_RX_AC_JTAG_INITN_ADDR A:0x67c58218
y.create.l HWIO_EMAC_0_EMAC_QSERDES_RX_AC_JTAG_LVL_EN_ADDR A:0x67c5821c
y.create.l HWIO_EMAC_0_EMAC_QSERDES_RX_AC_JTAG_MODE_ADDR A:0x67c58220
y.create.l HWIO_EMAC_0_EMAC_QSERDES_RX_AC_JTAG_RESET_ADDR A:0x67c58224
y.create.l HWIO_EMAC_0_EMAC_QSERDES_RX_RX_IQ_RXDET_EN_ADDR A:0x67c58228
y.create.l HWIO_EMAC_0_EMAC_QSERDES_RX_RX_TERM_HIGHZ_CM_AC_COUPLE_ADDR A:0x67c5822c
y.create.l HWIO_EMAC_0_EMAC_QSERDES_RX_RX_EQ_GAIN12_ADDR A:0x67c58230
y.create.l HWIO_EMAC_0_EMAC_QSERDES_RX_SIGDET_CNTRL_ADDR A:0x67c58234
y.create.l HWIO_EMAC_0_EMAC_QSERDES_RX_RX_BAND_ADDR A:0x67c58238
y.create.l HWIO_EMAC_0_EMAC_QSERDES_RX_CDR_FREEZE_UP_DN_ADDR A:0x67c5823c
y.create.l HWIO_EMAC_0_EMAC_QSERDES_RX_RX_INTERFACE_MODE_ADDR A:0x67c58240
y.create.l HWIO_EMAC_0_EMAC_QSERDES_RX_JITTER_GEN_MODE_ADDR A:0x67c58244
y.create.l HWIO_EMAC_0_EMAC_QSERDES_RX_BUJ_AMP_ADDR A:0x67c58248
y.create.l HWIO_EMAC_0_EMAC_QSERDES_RX_SJ_AMP1_ADDR A:0x67c5824c
y.create.l HWIO_EMAC_0_EMAC_QSERDES_RX_SJ_AMP2_ADDR A:0x67c58250
y.create.l HWIO_EMAC_0_EMAC_QSERDES_RX_SJ_PER1_ADDR A:0x67c58254
y.create.l HWIO_EMAC_0_EMAC_QSERDES_RX_SJ_PER2_ADDR A:0x67c58258
y.create.l HWIO_EMAC_0_EMAC_QSERDES_RX_BUJ_STEP_FREQ1_ADDR A:0x67c5825c
y.create.l HWIO_EMAC_0_EMAC_QSERDES_RX_BUJ_STEP_FREQ2_ADDR A:0x67c58260
y.create.l HWIO_EMAC_0_EMAC_QSERDES_RX_PPM_OFFSET1_ADDR A:0x67c58264
y.create.l HWIO_EMAC_0_EMAC_QSERDES_RX_PPM_OFFSET2_ADDR A:0x67c58268
y.create.l HWIO_EMAC_0_EMAC_QSERDES_RX_SIGN_PPM_PERIOD1_ADDR A:0x67c5826c
y.create.l HWIO_EMAC_0_EMAC_QSERDES_RX_SIGN_PPM_PERIOD2_ADDR A:0x67c58270
y.create.l HWIO_EMAC_0_EMAC_QSERDES_RX_SSC_CTRL_ADDR A:0x67c58274
y.create.l HWIO_EMAC_0_EMAC_QSERDES_RX_SSC_COUNT1_ADDR A:0x67c58278
y.create.l HWIO_EMAC_0_EMAC_QSERDES_RX_SSC_COUNT2_ADDR A:0x67c5827c
y.create.l HWIO_EMAC_0_EMAC_QSERDES_RX_PWM_CNTRL1_ADDR A:0x67c58280
y.create.l HWIO_EMAC_0_EMAC_QSERDES_RX_PWM_CNTRL2_ADDR A:0x67c58284
y.create.l HWIO_EMAC_0_EMAC_QSERDES_RX_PWM_NDIV_ADDR A:0x67c58288
y.create.l HWIO_EMAC_0_EMAC_QSERDES_RX_PI_CTRL1_ADDR A:0x67c5828c
y.create.l HWIO_EMAC_0_EMAC_QSERDES_RX_PI_CTRL2_ADDR A:0x67c58290
y.create.l HWIO_EMAC_0_EMAC_QSERDES_RX_PI_QUAD_ADDR A:0x67c58294
y.create.l HWIO_EMAC_0_EMAC_QSERDES_RX_IDATA1_ADDR A:0x67c58298
y.create.l HWIO_EMAC_0_EMAC_QSERDES_RX_IDATA2_ADDR A:0x67c5829c
y.create.l HWIO_EMAC_0_EMAC_QSERDES_RX_AUX_DATA1_ADDR A:0x67c582a0
y.create.l HWIO_EMAC_0_EMAC_QSERDES_RX_AUX_DATA2_ADDR A:0x67c582a4
y.create.l HWIO_EMAC_0_EMAC_QSERDES_RX_AC_JTAG_OUTP_ADDR A:0x67c582a8
y.create.l HWIO_EMAC_0_EMAC_QSERDES_RX_AC_JTAG_OUTN_ADDR A:0x67c582ac
y.create.l HWIO_EMAC_0_EMAC_QSERDES_RX_RX_SIGDET_PWMDECSTATUS_ADDR A:0x67c582b0
y.create.l HWIO_EMAC_0_EMAC_SGMII_PHY_SERDES_START_ADDR A:0x67c58300
y.create.l HWIO_EMAC_0_EMAC_SGMII_PHY_CMN_PWR_CTRL_ADDR A:0x67c58304
y.create.l HWIO_EMAC_0_EMAC_SGMII_PHY_RX_PWR_CTRL_ADDR A:0x67c58308
y.create.l HWIO_EMAC_0_EMAC_SGMII_PHY_TX_PWR_CTRL_ADDR A:0x67c5830c
y.create.l HWIO_EMAC_0_EMAC_SGMII_PHY_CMN_CTRL_ADDR A:0x67c58310
y.create.l HWIO_EMAC_0_EMAC_SGMII_PHY_LANE_CTRL0_ADDR A:0x67c58314
y.create.l HWIO_EMAC_0_EMAC_SGMII_PHY_LANE_CTRL1_ADDR A:0x67c58318
y.create.l HWIO_EMAC_0_EMAC_SGMII_PHY_PRBS_CFG0_ADDR A:0x67c5831c
y.create.l HWIO_EMAC_0_EMAC_SGMII_PHY_PRBS_CFG1_ADDR A:0x67c58320
y.create.l HWIO_EMAC_0_EMAC_SGMII_PHY_PRBS_CFG2_ADDR A:0x67c58324
y.create.l HWIO_EMAC_0_EMAC_SGMII_PHY_PRBS_CFG3_ADDR A:0x67c58328
y.create.l HWIO_EMAC_0_EMAC_SGMII_PHY_PRBS_CFG4_ADDR A:0x67c5832c
y.create.l HWIO_EMAC_0_EMAC_SGMII_PHY_PRBS_CFG5_ADDR A:0x67c58330
y.create.l HWIO_EMAC_0_EMAC_SGMII_PHY_PRBS_CFG6_ADDR A:0x67c58334
y.create.l HWIO_EMAC_0_EMAC_SGMII_PHY_PRBS_CFG7_ADDR A:0x67c58338
y.create.l HWIO_EMAC_0_EMAC_SGMII_PHY_8B10B_CFG_ADDR A:0x67c5833c
y.create.l HWIO_EMAC_0_EMAC_SGMII_PHY_AUTONEG_CFG0_ADDR A:0x67c58340
y.create.l HWIO_EMAC_0_EMAC_SGMII_PHY_AUTONEG_CFG1_ADDR A:0x67c58344
y.create.l HWIO_EMAC_0_EMAC_SGMII_PHY_AUTONEG_CFG2_ADDR A:0x67c58348
y.create.l HWIO_EMAC_0_EMAC_SGMII_PHY_AUTONEG_CFG3_ADDR A:0x67c5834c
y.create.l HWIO_EMAC_0_EMAC_SGMII_PHY_AUTONEG_CFG4_ADDR A:0x67c58350
y.create.l HWIO_EMAC_0_EMAC_SGMII_PHY_CDR_CTRL0_ADDR A:0x67c58358
y.create.l HWIO_EMAC_0_EMAC_SGMII_PHY_CDR_CTRL1_ADDR A:0x67c5835c
y.create.l HWIO_EMAC_0_EMAC_SGMII_PHY_SPEED_CFG0_ADDR A:0x67c58370
y.create.l HWIO_EMAC_0_EMAC_SGMII_PHY_SPEED_CFG1_ADDR A:0x67c58374
y.create.l HWIO_EMAC_0_EMAC_SGMII_PHY_POW_DWN_CTRL0_ADDR A:0x67c58380
y.create.l HWIO_EMAC_0_EMAC_SGMII_PHY_TX_DATA_CTRL_ADDR A:0x67c58388
y.create.l HWIO_EMAC_0_EMAC_SGMII_PHY_BIST_GEN0_ADDR A:0x67c5838c
y.create.l HWIO_EMAC_0_EMAC_SGMII_PHY_BIST_GEN1_ADDR A:0x67c58390
y.create.l HWIO_EMAC_0_EMAC_SGMII_PHY_BIST_GEN2_ADDR A:0x67c58394
y.create.l HWIO_EMAC_0_EMAC_SGMII_PHY_BIST_GEN3_ADDR A:0x67c58398
y.create.l HWIO_EMAC_0_EMAC_SGMII_PHY_TEST_DEBUG_CTRL_ADDR A:0x67c583a0
y.create.l HWIO_EMAC_0_EMAC_SGMII_PHY_ALIGNP_ADDR A:0x67c583a4
y.create.l HWIO_EMAC_0_EMAC_SGMII_PHY_RESET_CTRL_ADDR A:0x67c583a8
y.create.l HWIO_EMAC_0_EMAC_SGMII_PHY_IRQ_CMD_ADDR A:0x67c583ac
y.create.l HWIO_EMAC_0_EMAC_SGMII_PHY_INTERRUPT_CLEAR_ADDR A:0x67c583b0
y.create.l HWIO_EMAC_0_EMAC_SGMII_PHY_INTERRUPT_MASK_ADDR A:0x67c583b4
y.create.l HWIO_EMAC_0_EMAC_SGMII_PHY_INTERRUPT_STATUS_ADDR A:0x67c583b8
y.create.l HWIO_EMAC_0_EMAC_SGMII_PHY_REVISION_ID0_ADDR A:0x67c583bc
y.create.l HWIO_EMAC_0_EMAC_SGMII_PHY_REVISION_ID1_ADDR A:0x67c583c0
y.create.l HWIO_EMAC_0_EMAC_SGMII_PHY_REVISION_ID2_ADDR A:0x67c583c4
y.create.l HWIO_EMAC_0_EMAC_SGMII_PHY_REVISION_ID3_ADDR A:0x67c583c8
y.create.l HWIO_EMAC_0_EMAC_SGMII_PHY_RX_CHK_ERR_CNT0_STATUS_ADDR A:0x67c583cc
y.create.l HWIO_EMAC_0_EMAC_SGMII_PHY_RX_CHK_ERR_CNT1_STATUS_ADDR A:0x67c583d0
y.create.l HWIO_EMAC_0_EMAC_SGMII_PHY_RX_CHK_STATUS_ADDR A:0x67c583d4
y.create.l HWIO_EMAC_0_EMAC_SGMII_PHY_RX_MIS_ALIGN_ERR_STATUS_ADDR A:0x67c583d8
y.create.l HWIO_EMAC_0_EMAC_SGMII_PHY_AUTONEG0_STATUS_ADDR A:0x67c583e0
y.create.l HWIO_EMAC_0_EMAC_SGMII_PHY_AUTONEG1_STATUS_ADDR A:0x67c583e4
y.create.l HWIO_EMAC_0_EMAC_SGMII_PHY_AUTONEG2_STATUS_ADDR A:0x67c583e8
y.create.l HWIO_EMAC_0_EMAC_SGMII_PHY_AUTONEG3_STATUS_ADDR A:0x67c583ec
y.create.l HWIO_EMAC_0_EMAC_SGMII_PHY_DEBUG_BUS_STAT0_ADDR A:0x67c583f0
y.create.l HWIO_EMAC_0_EMAC_SGMII_PHY_DEBUG_BUS_STAT1_ADDR A:0x67c583f4
y.create.l HWIO_EMAC_0_EMAC_SGMII_PHY_DEBUG_BUS_STAT2_ADDR A:0x67c583f8
y.create.l HWIO_EMAC_0_EMAC_SGMII_PHY_DEBUG_BUS_STAT3_ADDR A:0x67c583fc
y.create.l HWIO_MPM2_MPM_PMIC_VDD_ON_CFG_1_ADDR A:0x604a0000
y.create.l HWIO_MPM2_MPM_PMIC_VDD_ON_CFG_2_ADDR A:0x604a0004
y.create.l HWIO_MPM2_MPM_PMIC_VDD_ON_CFG_3_ADDR A:0x604a0008
y.create.l HWIO_MPM2_MPM_PMIC_VDD_ON_CFG_4_ADDR A:0x604a000c
y.create.l HWIO_MPM2_MPM_PMIC_VDD_ON_CFG_5_ADDR A:0x604a0010
y.create.l HWIO_MPM2_MPM_PMIC_VDD_ON_CFG_6_ADDR A:0x604a0014
y.create.l HWIO_MPM2_MPM_PMIC_VDD_ON_CFG_7_ADDR A:0x604a0018
y.create.l HWIO_MPM2_MPM_PMIC_VDD_ON_CFG_8_ADDR A:0x604a001c
y.create.l HWIO_MPM2_MPM_PMIC_VDD_ON_CFG_9_ADDR A:0x604a0020
y.create.l HWIO_MPM2_MPM_PMIC_VDD_ON_CFG_10_ADDR A:0x604a0024
y.create.l HWIO_MPM2_MPM_PMIC_VDD_ON_CFG_11_ADDR A:0x604a0028
y.create.l HWIO_MPM2_MPM_PMIC_VDD_ON_CFG_12_ADDR A:0x604a002c
y.create.l HWIO_MPM2_MPM_PMIC_VDD_OFF_CFG_1_ADDR A:0x604a0030
y.create.l HWIO_MPM2_MPM_PMIC_VDD_OFF_CFG_2_ADDR A:0x604a0034
y.create.l HWIO_MPM2_MPM_PMIC_VDD_OFF_CFG_3_ADDR A:0x604a0038
y.create.l HWIO_MPM2_MPM_PMIC_VDD_OFF_CFG_4_ADDR A:0x604a003c
y.create.l HWIO_MPM2_MPM_PMIC_VDD_OFF_CFG_5_ADDR A:0x604a0040
y.create.l HWIO_MPM2_MPM_PMIC_VDD_OFF_CFG_6_ADDR A:0x604a0044
y.create.l HWIO_MPM2_MPM_PMIC_VDD_OFF_CFG_7_ADDR A:0x604a0048
y.create.l HWIO_MPM2_MPM_PMIC_VDD_OFF_CFG_8_ADDR A:0x604a004c
y.create.l HWIO_MPM2_MPM_PMIC_VDD_OFF_CFG_9_ADDR A:0x604a0050
y.create.l HWIO_MPM2_MPM_PMIC_VDD_OFF_CFG_10_ADDR A:0x604a0054
y.create.l HWIO_MPM2_MPM_PMIC_VDD_OFF_CFG_11_ADDR A:0x604a0058
y.create.l HWIO_MPM2_MPM_PMIC_VDD_OFF_CFG_12_ADDR A:0x604a005c
y.create.l HWIO_MPM2_MPM_SPMI_CMD_CFG_ADDR A:0x604a0060
y.create.l HWIO_MPM2_MPM_SPMI_CDIV_CNTRL_ADDR A:0x604a0064
y.create.l HWIO_MPM2_MPM_CXO_CTRL_ADDR A:0x604a0068
y.create.l HWIO_MPM2_MPM_PXO_OSC_CTRL_ADDR A:0x604a006c
y.create.l HWIO_MPM2_MPM_LOW_POWER_CFG_ADDR A:0x604a0070
y.create.l HWIO_MPM2_MPM_LOW_POWER_STATUS_ADDR A:0x604a0074
y.create.l HWIO_MPM2_MPM_CXO_POWER_RAMPUP_TIME_ADDR A:0x604a0078
y.create.l HWIO_MPM2_MPM_PXO_WARMUP_TIME_ADDR A:0x604a007c
y.create.l HWIO_MPM2_MPM_HARDWARE_RESTORED_ADDR A:0x604a0080
y.create.l HWIO_MPM2_MPM_INT_CLEAR_1_ADDR A:0x604a0084
y.create.l HWIO_MPM2_MPM_INT_CLEAR_2_ADDR A:0x604a0088
y.create.l HWIO_MPM2_MPM_INT_EN_1_ADDR A:0x604a008c
y.create.l HWIO_MPM2_MPM_INT_EN_2_ADDR A:0x604a0090
y.create.l HWIO_MPM2_MPM_INT_POLARITY_1_ADDR A:0x604a0094
y.create.l HWIO_MPM2_MPM_INT_POLARITY_2_ADDR A:0x604a0098
y.create.l HWIO_MPM2_MPM_DETECT_CTL_1_ADDR A:0x604a009c
y.create.l HWIO_MPM2_MPM_DETECT_CTL_2_ADDR A:0x604a00a0
y.create.l HWIO_MPM2_MPM_DETECT_CTL_3_ADDR A:0x604a00a4
y.create.l HWIO_MPM2_MPM_DETECT_CTL_4_ADDR A:0x604a00a8
y.create.l HWIO_MPM2_MPM_INT_STATUS_1_ADDR A:0x604a00ac
y.create.l HWIO_MPM2_MPM_INT_STATUS_2_ADDR A:0x604a00b0
y.create.l HWIO_MPM2_MPM_INT_WKUP_CLK_SEL_1_ADDR A:0x604a00b4
y.create.l HWIO_MPM2_MPM_INT_WKUP_CLK_SEL_2_ADDR A:0x604a00b8
y.create.l HWIO_MPM2_MPM_DEBUG_BUS_EN_ADDR A:0x604a00bc
y.create.l HWIO_MPM2_MPM_PEN_DEBOUNCE_CTL_ADDR A:0x604a00c0
y.create.l HWIO_MPM2_MPM_WARM_BOOT_CFG_ADDR A:0x604a00c4
y.create.l HWIO_MPM2_MPM_REG0_FILE_ADDR A:0x604a00c8
y.create.l HWIO_MPM2_MPM_REG1_FILE_ADDR A:0x604a00cc
y.create.l HWIO_MPM2_MPM_REG2_FILE_ADDR A:0x604a00d0
y.create.l HWIO_MPM2_MPM_REG3_FILE_ADDR A:0x604a00d4
y.create.l HWIO_MPM2_MPM_REG4_FILE_ADDR A:0x604a00d8
y.create.l HWIO_MPM2_MPM_REG5_FILE_ADDR A:0x604a00dc
y.create.l HWIO_MPM2_MPM_REG6_FILE_ADDR A:0x604a00e0
y.create.l HWIO_MPM2_MPM_REG7_FILE_ADDR A:0x604a00e4
y.create.l HWIO_MPM2_MPM_REG8_FILE_ADDR A:0x604a00e8
y.create.l HWIO_MPM2_MPM_CNTR_CLK_CONTROL_ADDR A:0x604a00ec
y.create.l HWIO_MPM2_MPM_CNTR_FRAC_ADDR A:0x604a00f0
y.create.l HWIO_MPM2_MPM_CNTR_INCR_DATA_ADDR A:0x604a00f4
y.create.l HWIO_MPM2_MPM_HW_ID_ADDR A:0x604a00f8
y.create.l HWIO_MPM2_MPM_CONTROL_CNTCR_ADDR A:0x604a1000
y.create.l HWIO_MPM2_MPM_CONTROL_CNTSR_ADDR A:0x604a1004
y.create.l HWIO_MPM2_MPM_CONTROL_CNTCV_LO_ADDR A:0x604a1008
y.create.l HWIO_MPM2_MPM_CONTROL_CNTCV_HI_ADDR A:0x604a100c
y.create.l HWIO_MPM2_MPM_CONTROL_CNTFID0_ADDR A:0x604a1020
y.create.l HWIO_MPM2_MPM_CONTROL_ID_ADDR A:0x604a1fd0
y.create.l HWIO_MPM2_MPM_READ_CNTCV_LO_ADDR A:0x604a2000
y.create.l HWIO_MPM2_MPM_READ_CNTCV_HI_ADDR A:0x604a2004
y.create.l HWIO_MPM2_MPM_READ_ID_ADDR A:0x604a2fd0
y.create.l HWIO_MPM2_MPM_SLEEP_TIMETICK_COUNT_VAL_ADDR A:0x604a3000
y.create.l HWIO_MPM2_QTMR_AC_CNTFRQ_ADDR A:0x604a4000
y.create.l HWIO_MPM2_QTMR_AC_CNTSR_ADDR A:0x604a4004
y.create.l HWIO_MPM2_QTMR_AC_CNTTID_ADDR A:0x604a4008
y.create.l HWIO_MPM2_QTMR_AC_CNTACR_0_ADDR A:0x604a4040
y.create.l HWIO_MPM2_QTMR_AC_CNTVOFF_LO_0_ADDR A:0x604a4080
y.create.l HWIO_MPM2_QTMR_AC_CNTVOFF_HI_0_ADDR A:0x604a4084
y.create.l HWIO_MPM2_QTMR_AC_CFG_ADDR A:0x604a4fc0
y.create.l HWIO_MPM2_QTMR_AC_VERSION_ADDR A:0x604a4fd0
y.create.l HWIO_MPM2_QTMR_V1_CNTPCT_LO_ADDR A:0x604a5000
y.create.l HWIO_MPM2_QTMR_V1_CNTPCT_HI_ADDR A:0x604a5004
y.create.l HWIO_MPM2_QTMR_V1_CNTVCT_LO_ADDR A:0x604a5008
y.create.l HWIO_MPM2_QTMR_V1_CNTVCT_HI_ADDR A:0x604a500c
y.create.l HWIO_MPM2_QTMR_V1_CNTFRQ_ADDR A:0x604a5010
y.create.l HWIO_MPM2_QTMR_V1_CNTPL0ACR_ADDR A:0x604a5014
y.create.l HWIO_MPM2_QTMR_V1_CNTVOFF_LO_ADDR A:0x604a5018
y.create.l HWIO_MPM2_QTMR_V1_CNTVOFF_HI_ADDR A:0x604a501c
y.create.l HWIO_MPM2_QTMR_V1_CNTP_CVAL_LO_ADDR A:0x604a5020
y.create.l HWIO_MPM2_QTMR_V1_CNTP_CVAL_HI_ADDR A:0x604a5024
y.create.l HWIO_MPM2_QTMR_V1_CNTP_TVAL_ADDR A:0x604a5028
y.create.l HWIO_MPM2_QTMR_V1_CNTP_CTL_ADDR A:0x604a502c
y.create.l HWIO_MPM2_QTMR_V1_CNTV_CVAL_LO_ADDR A:0x604a5030
y.create.l HWIO_MPM2_QTMR_V1_CNTV_CVAL_HI_ADDR A:0x604a5034
y.create.l HWIO_MPM2_QTMR_V1_CNTV_TVAL_ADDR A:0x604a5038
y.create.l HWIO_MPM2_QTMR_V1_CNTV_CTL_ADDR A:0x604a503c
y.create.l HWIO_MPM2_QTMR_V1_VERSION_ADDR A:0x604a5fd0
y.create.l HWIO_MPM2_MPM_TSYNC_CTL_ADDR A:0x604a6000
y.create.l HWIO_MPM2_MPM_TSYNC_CMD_ADDR A:0x604a6004
y.create.l HWIO_MPM2_MPM_TSYNC_START_ADDR A:0x604a6008
y.create.l HWIO_MPM2_MPM_TSYNC_START_PHASE_ADDR A:0x604a600c
y.create.l HWIO_MPM2_MPM_TSYNC_PERIOD_ADDR A:0x604a6010
y.create.l HWIO_MPM2_MPM_TSYNC_PERIOD_PHASE_ADDR A:0x604a6014
y.create.l HWIO_MPM2_MPM_TSYNC_STATUS_TIME_ADDR A:0x604a6018
y.create.l HWIO_MPM2_MPM_TSYNC_STATUS_PHASE_ADDR A:0x604a601c
y.create.l HWIO_MPM2_MPM_GRFC_CXO_EN_ADDR A:0x604a6020
y.create.l HWIO_MPM2_XPU_SCR_ADDR A:0x604a7000
y.create.l HWIO_MPM2_XPU_SWDR_ADDR A:0x604a7004
y.create.l HWIO_MPM2_XPU_SEAR0_ADDR A:0x604a7040
y.create.l HWIO_MPM2_XPU_SESR_ADDR A:0x604a7048
y.create.l HWIO_MPM2_XPU_SESRRESTORE_ADDR A:0x604a704c
y.create.l HWIO_MPM2_XPU_SESYNR0_ADDR A:0x604a7050
y.create.l HWIO_MPM2_XPU_SESYNR1_ADDR A:0x604a7054
y.create.l HWIO_MPM2_XPU_SESYNR2_ADDR A:0x604a7058
y.create.l HWIO_MPM2_XPU_MCR_ADDR A:0x604a7100
y.create.l HWIO_MPM2_XPU_MEAR0_ADDR A:0x604a7140
y.create.l HWIO_MPM2_XPU_MESR_ADDR A:0x604a7148
y.create.l HWIO_MPM2_XPU_MESRRESTORE_ADDR A:0x604a714c
y.create.l HWIO_MPM2_XPU_MESYNR0_ADDR A:0x604a7150
y.create.l HWIO_MPM2_XPU_MESYNR1_ADDR A:0x604a7154
y.create.l HWIO_MPM2_XPU_MESYNR2_ADDR A:0x604a7158
y.create.l HWIO_MPM2_XPU_CR_ADDR A:0x604a7080
y.create.l HWIO_MPM2_XPU_RPU_ACR0_ADDR A:0x604a70a0
y.create.l HWIO_MPM2_XPU_EAR0_ADDR A:0x604a70c0
y.create.l HWIO_MPM2_XPU_ESR_ADDR A:0x604a70c8
y.create.l HWIO_MPM2_XPU_ESRRESTORE_ADDR A:0x604a70cc
y.create.l HWIO_MPM2_XPU_ESYNR0_ADDR A:0x604a70d0
y.create.l HWIO_MPM2_XPU_ESYNR1_ADDR A:0x604a70d4
y.create.l HWIO_MPM2_XPU_ESYNR2_ADDR A:0x604a70d8
y.create.l HWIO_MPM2_XPU_IDR0_ADDR A:0x604a7074
y.create.l HWIO_MPM2_XPU_IDR1_ADDR A:0x604a7078
y.create.l HWIO_MPM2_XPU_REV_ADDR A:0x604a707c
y.create.l HWIO_MPM2_XPU_RG0_RACR0_ADDR A:0x604a7200
y.create.l HWIO_MPM2_XPU_RG1_RACR0_ADDR A:0x604a7280
y.create.l HWIO_MPM2_XPU_RG2_RACR0_ADDR A:0x604a7300
y.create.l HWIO_MPM2_XPU_RG3_RACR0_ADDR A:0x604a7380
y.create.l HWIO_MPM2_XPU_RG4_RACR0_ADDR A:0x604a7400
y.create.l HWIO_MPM2_XPU_RG5_RACR0_ADDR A:0x604a7480
y.create.l HWIO_MPM2_XPU_RG6_RACR0_ADDR A:0x604a7500
y.create.l HWIO_MPM2_XPU_RG7_RACR0_ADDR A:0x604a7580
y.create.l HWIO_MPM2_XPU_RG8_RACR0_ADDR A:0x604a7600
y.create.l HWIO_MPM2_XPU_RG9_RACR0_ADDR A:0x604a7680
y.create.l HWIO_MPM2_XPU_RG0_SCR_ADDR A:0x604a7250
y.create.l HWIO_MPM2_XPU_RG1_SCR_ADDR A:0x604a72d0
y.create.l HWIO_MPM2_XPU_RG2_SCR_ADDR A:0x604a7350
y.create.l HWIO_MPM2_XPU_RG3_SCR_ADDR A:0x604a73d0
y.create.l HWIO_MPM2_XPU_RG4_SCR_ADDR A:0x604a7450
y.create.l HWIO_MPM2_XPU_RG5_SCR_ADDR A:0x604a74d0
y.create.l HWIO_MPM2_XPU_RG6_SCR_ADDR A:0x604a7550
y.create.l HWIO_MPM2_XPU_RG7_SCR_ADDR A:0x604a75d0
y.create.l HWIO_MPM2_XPU_RG8_SCR_ADDR A:0x604a7650
y.create.l HWIO_MPM2_XPU_RG9_SCR_ADDR A:0x604a76d0
y.create.l HWIO_MPM2_XPU_RG0_MCR_ADDR A:0x604a7254
y.create.l HWIO_MPM2_XPU_RG1_MCR_ADDR A:0x604a72d4
y.create.l HWIO_MPM2_XPU_RG2_MCR_ADDR A:0x604a7354
y.create.l HWIO_MPM2_XPU_RG3_MCR_ADDR A:0x604a73d4
y.create.l HWIO_MPM2_XPU_RG4_MCR_ADDR A:0x604a7454
y.create.l HWIO_MPM2_XPU_RG5_MCR_ADDR A:0x604a74d4
y.create.l HWIO_MPM2_XPU_RG6_MCR_ADDR A:0x604a7554
y.create.l HWIO_MPM2_XPU_RG7_MCR_ADDR A:0x604a75d4
y.create.l HWIO_MPM2_XPU_RG8_MCR_ADDR A:0x604a7654
y.create.l HWIO_MPM2_XPU_RG9_MCR_ADDR A:0x604a76d4
y.create.l HWIO_MPM2_TSENS_CTRL_ADDR A:0x604a8000
y.create.l HWIO_MPM2_TSENS_TEST_CTRL_ADDR A:0x604a8004
y.create.l HWIO_MPM2_TSENS_S0_MIN_MAX_STATUS_CTRL_ADDR A:0x604a8008
y.create.l HWIO_MPM2_TSENS_S1_MIN_MAX_STATUS_CTRL_ADDR A:0x604a800c
y.create.l HWIO_MPM2_TSENS_S2_MIN_MAX_STATUS_CTRL_ADDR A:0x604a8010
y.create.l HWIO_MPM2_TSENS_S3_MIN_MAX_STATUS_CTRL_ADDR A:0x604a8014
y.create.l HWIO_MPM2_TSENS_S4_MIN_MAX_STATUS_CTRL_ADDR A:0x604a8018
y.create.l HWIO_MPM2_TSENS_S5_MIN_MAX_STATUS_CTRL_ADDR A:0x604a801c
y.create.l HWIO_MPM2_TSENS_S6_MIN_MAX_STATUS_CTRL_ADDR A:0x604a8020
y.create.l HWIO_MPM2_TSENS_S7_MIN_MAX_STATUS_CTRL_ADDR A:0x604a8024
y.create.l HWIO_MPM2_TSENS_S8_MIN_MAX_STATUS_CTRL_ADDR A:0x604a8028
y.create.l HWIO_MPM2_TSENS_S9_MIN_MAX_STATUS_CTRL_ADDR A:0x604a802c
y.create.l HWIO_MPM2_TSENS_GLOBAL_CONFIG_ADDR A:0x604a8034
y.create.l HWIO_MPM2_TSENS_S0_MAIN_CONFIG_ADDR A:0x604a8038
y.create.l HWIO_MPM2_TSENS_S1_REMOTE_CONFIG_ADDR A:0x604a8040
y.create.l HWIO_MPM2_TSENS_S2_REMOTE_CONFIG_ADDR A:0x604a8044
y.create.l HWIO_MPM2_TSENS_S3_REMOTE_CONFIG_ADDR A:0x604a8048
y.create.l HWIO_MPM2_TSENS_S4_REMOTE_CONFIG_ADDR A:0x604a804c
y.create.l HWIO_MPM2_TSENS_S5_REMOTE_CONFIG_ADDR A:0x604a8050
y.create.l HWIO_MPM2_TSENS_S6_REMOTE_CONFIG_ADDR A:0x604a8054
y.create.l HWIO_MPM2_TSENS_S7_REMOTE_CONFIG_ADDR A:0x604a8058
y.create.l HWIO_MPM2_TSENS_S8_REMOTE_CONFIG_ADDR A:0x604a805c
y.create.l HWIO_MPM2_TSENS_S9_REMOTE_CONFIG_ADDR A:0x604a8060
y.create.l HWIO_MPM2_TSENS_S10_REMOTE_CONFIG_ADDR A:0x604a8064
y.create.l HWIO_MPM2_TSENS_UPPER_LOWER_INTERRUPT_CTRL_ADDR A:0x604a9000
y.create.l HWIO_MPM2_TSENS_S0_UPPER_LOWER_STATUS_CTRL_ADDR A:0x604a9004
y.create.l HWIO_MPM2_TSENS_S1_UPPER_LOWER_STATUS_CTRL_ADDR A:0x604a9008
y.create.l HWIO_MPM2_TSENS_S2_UPPER_LOWER_STATUS_CTRL_ADDR A:0x604a900c
y.create.l HWIO_MPM2_TSENS_S3_UPPER_LOWER_STATUS_CTRL_ADDR A:0x604a9010
y.create.l HWIO_MPM2_TSENS_S4_UPPER_LOWER_STATUS_CTRL_ADDR A:0x604a9014
y.create.l HWIO_MPM2_TSENS_S5_UPPER_LOWER_STATUS_CTRL_ADDR A:0x604a9018
y.create.l HWIO_MPM2_TSENS_S6_UPPER_LOWER_STATUS_CTRL_ADDR A:0x604a901c
y.create.l HWIO_MPM2_TSENS_S7_UPPER_LOWER_STATUS_CTRL_ADDR A:0x604a9020
y.create.l HWIO_MPM2_TSENS_S8_UPPER_LOWER_STATUS_CTRL_ADDR A:0x604a9024
y.create.l HWIO_MPM2_TSENS_S9_UPPER_LOWER_STATUS_CTRL_ADDR A:0x604a9028
y.create.l HWIO_MPM2_TSENS_S0_STATUS_ADDR A:0x604a9030
y.create.l HWIO_MPM2_TSENS_S1_STATUS_ADDR A:0x604a9034
y.create.l HWIO_MPM2_TSENS_S2_STATUS_ADDR A:0x604a9038
y.create.l HWIO_MPM2_TSENS_S3_STATUS_ADDR A:0x604a903c
y.create.l HWIO_MPM2_TSENS_S4_STATUS_ADDR A:0x604a9040
y.create.l HWIO_MPM2_TSENS_S5_STATUS_ADDR A:0x604a9044
y.create.l HWIO_MPM2_TSENS_S6_STATUS_ADDR A:0x604a9048
y.create.l HWIO_MPM2_TSENS_S7_STATUS_ADDR A:0x604a904c
y.create.l HWIO_MPM2_TSENS_S8_STATUS_ADDR A:0x604a9050
y.create.l HWIO_MPM2_TSENS_S9_STATUS_ADDR A:0x604a9054
y.create.l HWIO_MPM2_TSENS_TRDY_ADDR A:0x604a905c
y.create.l HWIO_MPM2_WDOG_RESET_REG_ADDR A:0x604aa000
y.create.l HWIO_MPM2_WDOG_CTL_REG_ADDR A:0x604aa004
y.create.l HWIO_MPM2_WDOG_STATUS_REG_ADDR A:0x604aa008
y.create.l HWIO_MPM2_WDOG_BARK_VAL_REG_ADDR A:0x604aa00c
y.create.l HWIO_MPM2_WDOG_BITE_VAL_REG_ADDR A:0x604aa010
y.create.l HWIO_MPM2_MPM_PS_HOLD_ADDR A:0x604ab000
y.create.l HWIO_MPM2_MPM_DDR_PHY_FREEZEIO_EBI1_ADDR A:0x604ab004
y.create.l HWIO_MSS_XPU_SCR_ADDR A:0x64000000
y.create.l HWIO_MSS_XPU_SWDR_ADDR A:0x64000004
y.create.l HWIO_MSS_XPU_SEAR0_ADDR A:0x64000040
y.create.l HWIO_MSS_XPU_SESR_ADDR A:0x64000048
y.create.l HWIO_MSS_XPU_SESRRESTORE_ADDR A:0x6400004c
y.create.l HWIO_MSS_XPU_SESYNR0_ADDR A:0x64000050
y.create.l HWIO_MSS_XPU_SESYNR1_ADDR A:0x64000054
y.create.l HWIO_MSS_XPU_SESYNR2_ADDR A:0x64000058
y.create.l HWIO_MSS_XPU_MCR_ADDR A:0x64000100
y.create.l HWIO_MSS_XPU_MEAR0_ADDR A:0x64000140
y.create.l HWIO_MSS_XPU_MESR_ADDR A:0x64000148
y.create.l HWIO_MSS_XPU_MESRRESTORE_ADDR A:0x6400014c
y.create.l HWIO_MSS_XPU_MESYNR0_ADDR A:0x64000150
y.create.l HWIO_MSS_XPU_MESYNR1_ADDR A:0x64000154
y.create.l HWIO_MSS_XPU_MESYNR2_ADDR A:0x64000158
y.create.l HWIO_MSS_XPU_CR_ADDR A:0x64000080
y.create.l HWIO_MSS_XPU_RPU_ACR0_ADDR A:0x640000a0
y.create.l HWIO_MSS_XPU_EAR0_ADDR A:0x640000c0
y.create.l HWIO_MSS_XPU_ESR_ADDR A:0x640000c8
y.create.l HWIO_MSS_XPU_ESRRESTORE_ADDR A:0x640000cc
y.create.l HWIO_MSS_XPU_ESYNR0_ADDR A:0x640000d0
y.create.l HWIO_MSS_XPU_ESYNR1_ADDR A:0x640000d4
y.create.l HWIO_MSS_XPU_ESYNR2_ADDR A:0x640000d8
y.create.l HWIO_MSS_XPU_IDR0_ADDR A:0x64000074
y.create.l HWIO_MSS_XPU_IDR1_ADDR A:0x64000078
y.create.l HWIO_MSS_XPU_REV_ADDR A:0x6400007c
y.create.l HWIO_MSS_XPU_RG0_RACR0_ADDR A:0x64000200
y.create.l HWIO_MSS_XPU_RG1_RACR0_ADDR A:0x64000280
y.create.l HWIO_MSS_XPU_RG2_RACR0_ADDR A:0x64000300
y.create.l HWIO_MSS_XPU_RG3_RACR0_ADDR A:0x64000380
y.create.l HWIO_MSS_XPU_RG4_RACR0_ADDR A:0x64000400
y.create.l HWIO_MSS_XPU_RG0_SCR_ADDR A:0x64000250
y.create.l HWIO_MSS_XPU_RG1_SCR_ADDR A:0x640002d0
y.create.l HWIO_MSS_XPU_RG2_SCR_ADDR A:0x64000350
y.create.l HWIO_MSS_XPU_RG3_SCR_ADDR A:0x640003d0
y.create.l HWIO_MSS_XPU_RG4_SCR_ADDR A:0x64000450
y.create.l HWIO_MSS_XPU_RG0_MCR_ADDR A:0x64000254
y.create.l HWIO_MSS_XPU_RG1_MCR_ADDR A:0x640002d4
y.create.l HWIO_MSS_XPU_RG2_MCR_ADDR A:0x64000354
y.create.l HWIO_MSS_XPU_RG3_MCR_ADDR A:0x640003d4
y.create.l HWIO_MSS_XPU_RG4_MCR_ADDR A:0x64000454
y.create.l HWIO_MSS_RELAY_MSG_BUFFER_00_ADDR A:0x64020000
y.create.l HWIO_MSS_RELAY_MSG_BUFFER_01_ADDR A:0x64020004
y.create.l HWIO_MSS_RELAY_MSG_BUFFER_02_ADDR A:0x64020008
y.create.l HWIO_MSS_RELAY_MSG_BUFFER_03_ADDR A:0x6402000c
y.create.l HWIO_MSS_RELAY_MSG_BUFFER_04_ADDR A:0x64020010
y.create.l HWIO_MSS_RELAY_MSG_BUFFER_05_ADDR A:0x64020014
y.create.l HWIO_MSS_RELAY_MSG_BUFFER_06_ADDR A:0x64020018
y.create.l HWIO_MSS_RELAY_MSG_BUFFER_07_ADDR A:0x6402001c
y.create.l HWIO_MSS_RELAY_MSG_BUFFER_08_ADDR A:0x64020020
y.create.l HWIO_MSS_RELAY_MSG_BUFFER_09_ADDR A:0x64020024
y.create.l HWIO_MSS_RELAY_MSG_BUFFER_10_ADDR A:0x64020028
y.create.l HWIO_MSS_RELAY_MSG_BUFFER_11_ADDR A:0x6402002c
y.create.l HWIO_MSS_RELAY_MSG_BUFFER_12_ADDR A:0x64020030
y.create.l HWIO_MSS_RELAY_MSG_BUFFER_13_ADDR A:0x64020034
y.create.l HWIO_MSS_RELAY_MSG_BUFFER_14_ADDR A:0x64020038
y.create.l HWIO_MSS_RELAY_MSG_BUFFER_15_ADDR A:0x6402003c
y.create.l HWIO_MSS_BAM_CTRL_ADDR A:0x64044000
y.create.l HWIO_MSS_BAM_TIMER_ADDR A:0x64044040
y.create.l HWIO_MSS_BAM_TIMER_CTRL_ADDR A:0x64044044
y.create.l HWIO_MSS_BAM_DESC_CNT_TRSHLD_ADDR A:0x64044008
y.create.l HWIO_MSS_BAM_IRQ_STTS_ADDR A:0x64044014
y.create.l HWIO_MSS_BAM_IRQ_CLR_ADDR A:0x64044018
y.create.l HWIO_MSS_BAM_IRQ_EN_ADDR A:0x6404401c
y.create.l HWIO_MSS_BAM_CNFG_BITS_ADDR A:0x6404407c
y.create.l HWIO_MSS_BAM_CNFG_BITS_2_ADDR A:0x64044084
y.create.l HWIO_MSS_BAM_REVISION_ADDR A:0x64045000
y.create.l HWIO_MSS_BAM_SW_VERSION_ADDR A:0x64045004
y.create.l HWIO_MSS_BAM_NUM_PIPES_ADDR A:0x64045008
y.create.l HWIO_MSS_BAM_TEST_BUS_SEL_ADDR A:0x64045010
y.create.l HWIO_MSS_BAM_TEST_BUS_REG_ADDR A:0x64045014
y.create.l HWIO_MSS_BAM_AHB_MASTER_ERR_CTRLS_ADDR A:0x64045024
y.create.l HWIO_MSS_BAM_AHB_MASTER_ERR_ADDR_ADDR A:0x64045028
y.create.l HWIO_MSS_BAM_AHB_MASTER_ERR_DATA_ADDR A:0x6404502c
y.create.l HWIO_MSS_BAM_AHB_MASTER_ERR_ADDR_LSB_ADDR A:0x64045100
y.create.l HWIO_MSS_BAM_AHB_MASTER_ERR_ADDR_MSB_ADDR A:0x64045104
y.create.l HWIO_MSS_BAM_TRUST_REG_ADDR A:0x64046000
y.create.l HWIO_MSS_BAM_P_TRUST_REG0_ADDR A:0x64046020
y.create.l HWIO_MSS_BAM_P_TRUST_REG1_ADDR A:0x64046024
y.create.l HWIO_MSS_BAM_P_TRUST_REG2_ADDR A:0x64046028
y.create.l HWIO_MSS_BAM_P_TRUST_REG3_ADDR A:0x6404602c
y.create.l HWIO_MSS_BAM_P_TRUST_REG4_ADDR A:0x64046030
y.create.l HWIO_MSS_BAM_P_TRUST_REG5_ADDR A:0x64046034
y.create.l HWIO_MSS_BAM_IRQ_SRCS_EE0_ADDR A:0x64047000
y.create.l HWIO_MSS_BAM_IRQ_SRCS_EE1_ADDR A:0x64048000
y.create.l HWIO_MSS_BAM_IRQ_SRCS_EE2_ADDR A:0x64049000
y.create.l HWIO_MSS_BAM_IRQ_SRCS_EE3_ADDR A:0x6404a000
y.create.l HWIO_MSS_BAM_IRQ_SRCS_EE4_ADDR A:0x6404b000
y.create.l HWIO_MSS_BAM_IRQ_SRCS_EE5_ADDR A:0x6404c000
y.create.l HWIO_MSS_BAM_IRQ_SRCS_EE6_ADDR A:0x6404d000
y.create.l HWIO_MSS_BAM_IRQ_SRCS_EE7_ADDR A:0x6404e000
y.create.l HWIO_MSS_BAM_IRQ_SRCS_MSK_EE0_ADDR A:0x64047004
y.create.l HWIO_MSS_BAM_IRQ_SRCS_MSK_EE1_ADDR A:0x64048004
y.create.l HWIO_MSS_BAM_IRQ_SRCS_MSK_EE2_ADDR A:0x64049004
y.create.l HWIO_MSS_BAM_IRQ_SRCS_MSK_EE3_ADDR A:0x6404a004
y.create.l HWIO_MSS_BAM_IRQ_SRCS_MSK_EE4_ADDR A:0x6404b004
y.create.l HWIO_MSS_BAM_IRQ_SRCS_MSK_EE5_ADDR A:0x6404c004
y.create.l HWIO_MSS_BAM_IRQ_SRCS_MSK_EE6_ADDR A:0x6404d004
y.create.l HWIO_MSS_BAM_IRQ_SRCS_MSK_EE7_ADDR A:0x6404e004
y.create.l HWIO_MSS_BAM_IRQ_SRCS_UNMASKED_EE0_ADDR A:0x64047008
y.create.l HWIO_MSS_BAM_IRQ_SRCS_UNMASKED_EE1_ADDR A:0x64048008
y.create.l HWIO_MSS_BAM_IRQ_SRCS_UNMASKED_EE2_ADDR A:0x64049008
y.create.l HWIO_MSS_BAM_IRQ_SRCS_UNMASKED_EE3_ADDR A:0x6404a008
y.create.l HWIO_MSS_BAM_IRQ_SRCS_UNMASKED_EE4_ADDR A:0x6404b008
y.create.l HWIO_MSS_BAM_IRQ_SRCS_UNMASKED_EE5_ADDR A:0x6404c008
y.create.l HWIO_MSS_BAM_IRQ_SRCS_UNMASKED_EE6_ADDR A:0x6404d008
y.create.l HWIO_MSS_BAM_IRQ_SRCS_UNMASKED_EE7_ADDR A:0x6404e008
y.create.l HWIO_MSS_BAM_PIPE_ATTR_EE0_ADDR A:0x6404700c
y.create.l HWIO_MSS_BAM_PIPE_ATTR_EE1_ADDR A:0x6404800c
y.create.l HWIO_MSS_BAM_PIPE_ATTR_EE2_ADDR A:0x6404900c
y.create.l HWIO_MSS_BAM_PIPE_ATTR_EE3_ADDR A:0x6404a00c
y.create.l HWIO_MSS_BAM_PIPE_ATTR_EE4_ADDR A:0x6404b00c
y.create.l HWIO_MSS_BAM_PIPE_ATTR_EE5_ADDR A:0x6404c00c
y.create.l HWIO_MSS_BAM_PIPE_ATTR_EE6_ADDR A:0x6404d00c
y.create.l HWIO_MSS_BAM_PIPE_ATTR_EE7_ADDR A:0x6404e00c
y.create.l HWIO_MSS_BAM_IRQ_SRCS_ADDR A:0x64047010
y.create.l HWIO_MSS_BAM_IRQ_SRCS_MSK_ADDR A:0x64047014
y.create.l HWIO_MSS_BAM_IRQ_SRCS_UNMASKED_ADDR A:0x64047018
y.create.l HWIO_MSS_BAM_P_CTRL0_ADDR A:0x64057000
y.create.l HWIO_MSS_BAM_P_CTRL1_ADDR A:0x64058000
y.create.l HWIO_MSS_BAM_P_CTRL2_ADDR A:0x64059000
y.create.l HWIO_MSS_BAM_P_CTRL3_ADDR A:0x6405a000
y.create.l HWIO_MSS_BAM_P_CTRL4_ADDR A:0x6405b000
y.create.l HWIO_MSS_BAM_P_CTRL5_ADDR A:0x6405c000
y.create.l HWIO_MSS_BAM_P_RST0_ADDR A:0x64057004
y.create.l HWIO_MSS_BAM_P_RST1_ADDR A:0x64058004
y.create.l HWIO_MSS_BAM_P_RST2_ADDR A:0x64059004
y.create.l HWIO_MSS_BAM_P_RST3_ADDR A:0x6405a004
y.create.l HWIO_MSS_BAM_P_RST4_ADDR A:0x6405b004
y.create.l HWIO_MSS_BAM_P_RST5_ADDR A:0x6405c004
y.create.l HWIO_MSS_BAM_P_HALT0_ADDR A:0x64057008
y.create.l HWIO_MSS_BAM_P_HALT1_ADDR A:0x64058008
y.create.l HWIO_MSS_BAM_P_HALT2_ADDR A:0x64059008
y.create.l HWIO_MSS_BAM_P_HALT3_ADDR A:0x6405a008
y.create.l HWIO_MSS_BAM_P_HALT4_ADDR A:0x6405b008
y.create.l HWIO_MSS_BAM_P_HALT5_ADDR A:0x6405c008
y.create.l HWIO_MSS_BAM_P_IRQ_STTS0_ADDR A:0x64057010
y.create.l HWIO_MSS_BAM_P_IRQ_STTS1_ADDR A:0x64058010
y.create.l HWIO_MSS_BAM_P_IRQ_STTS2_ADDR A:0x64059010
y.create.l HWIO_MSS_BAM_P_IRQ_STTS3_ADDR A:0x6405a010
y.create.l HWIO_MSS_BAM_P_IRQ_STTS4_ADDR A:0x6405b010
y.create.l HWIO_MSS_BAM_P_IRQ_STTS5_ADDR A:0x6405c010
y.create.l HWIO_MSS_BAM_P_IRQ_CLR0_ADDR A:0x64057014
y.create.l HWIO_MSS_BAM_P_IRQ_CLR1_ADDR A:0x64058014
y.create.l HWIO_MSS_BAM_P_IRQ_CLR2_ADDR A:0x64059014
y.create.l HWIO_MSS_BAM_P_IRQ_CLR3_ADDR A:0x6405a014
y.create.l HWIO_MSS_BAM_P_IRQ_CLR4_ADDR A:0x6405b014
y.create.l HWIO_MSS_BAM_P_IRQ_CLR5_ADDR A:0x6405c014
y.create.l HWIO_MSS_BAM_P_IRQ_EN0_ADDR A:0x64057018
y.create.l HWIO_MSS_BAM_P_IRQ_EN1_ADDR A:0x64058018
y.create.l HWIO_MSS_BAM_P_IRQ_EN2_ADDR A:0x64059018
y.create.l HWIO_MSS_BAM_P_IRQ_EN3_ADDR A:0x6405a018
y.create.l HWIO_MSS_BAM_P_IRQ_EN4_ADDR A:0x6405b018
y.create.l HWIO_MSS_BAM_P_IRQ_EN5_ADDR A:0x6405c018
y.create.l HWIO_MSS_BAM_P_TIMER0_ADDR A:0x6405701c
y.create.l HWIO_MSS_BAM_P_TIMER1_ADDR A:0x6405801c
y.create.l HWIO_MSS_BAM_P_TIMER2_ADDR A:0x6405901c
y.create.l HWIO_MSS_BAM_P_TIMER3_ADDR A:0x6405a01c
y.create.l HWIO_MSS_BAM_P_TIMER4_ADDR A:0x6405b01c
y.create.l HWIO_MSS_BAM_P_TIMER5_ADDR A:0x6405c01c
y.create.l HWIO_MSS_BAM_P_TIMER_CTRL0_ADDR A:0x64057020
y.create.l HWIO_MSS_BAM_P_TIMER_CTRL1_ADDR A:0x64058020
y.create.l HWIO_MSS_BAM_P_TIMER_CTRL2_ADDR A:0x64059020
y.create.l HWIO_MSS_BAM_P_TIMER_CTRL3_ADDR A:0x6405a020
y.create.l HWIO_MSS_BAM_P_TIMER_CTRL4_ADDR A:0x6405b020
y.create.l HWIO_MSS_BAM_P_TIMER_CTRL5_ADDR A:0x6405c020
y.create.l HWIO_MSS_BAM_P_PRDCR_SDBND0_ADDR A:0x64057024
y.create.l HWIO_MSS_BAM_P_PRDCR_SDBND1_ADDR A:0x64058024
y.create.l HWIO_MSS_BAM_P_PRDCR_SDBND2_ADDR A:0x64059024
y.create.l HWIO_MSS_BAM_P_PRDCR_SDBND3_ADDR A:0x6405a024
y.create.l HWIO_MSS_BAM_P_PRDCR_SDBND4_ADDR A:0x6405b024
y.create.l HWIO_MSS_BAM_P_PRDCR_SDBND5_ADDR A:0x6405c024
y.create.l HWIO_MSS_BAM_P_CNSMR_SDBND0_ADDR A:0x64057028
y.create.l HWIO_MSS_BAM_P_CNSMR_SDBND1_ADDR A:0x64058028
y.create.l HWIO_MSS_BAM_P_CNSMR_SDBND2_ADDR A:0x64059028
y.create.l HWIO_MSS_BAM_P_CNSMR_SDBND3_ADDR A:0x6405a028
y.create.l HWIO_MSS_BAM_P_CNSMR_SDBND4_ADDR A:0x6405b028
y.create.l HWIO_MSS_BAM_P_CNSMR_SDBND5_ADDR A:0x6405c028
y.create.l HWIO_MSS_BAM_P_SW_OFSTS0_ADDR A:0x64057800
y.create.l HWIO_MSS_BAM_P_SW_OFSTS1_ADDR A:0x64058800
y.create.l HWIO_MSS_BAM_P_SW_OFSTS2_ADDR A:0x64059800
y.create.l HWIO_MSS_BAM_P_SW_OFSTS3_ADDR A:0x6405a800
y.create.l HWIO_MSS_BAM_P_SW_OFSTS4_ADDR A:0x6405b800
y.create.l HWIO_MSS_BAM_P_SW_OFSTS5_ADDR A:0x6405c800
y.create.l HWIO_MSS_BAM_P_AU_PSM_CNTXT_1_0_ADDR A:0x64057804
y.create.l HWIO_MSS_BAM_P_AU_PSM_CNTXT_1_1_ADDR A:0x64058804
y.create.l HWIO_MSS_BAM_P_AU_PSM_CNTXT_1_2_ADDR A:0x64059804
y.create.l HWIO_MSS_BAM_P_AU_PSM_CNTXT_1_3_ADDR A:0x6405a804
y.create.l HWIO_MSS_BAM_P_AU_PSM_CNTXT_1_4_ADDR A:0x6405b804
y.create.l HWIO_MSS_BAM_P_AU_PSM_CNTXT_1_5_ADDR A:0x6405c804
y.create.l HWIO_MSS_BAM_P_PSM_CNTXT_2_0_ADDR A:0x64057808
y.create.l HWIO_MSS_BAM_P_PSM_CNTXT_2_1_ADDR A:0x64058808
y.create.l HWIO_MSS_BAM_P_PSM_CNTXT_2_2_ADDR A:0x64059808
y.create.l HWIO_MSS_BAM_P_PSM_CNTXT_2_3_ADDR A:0x6405a808
y.create.l HWIO_MSS_BAM_P_PSM_CNTXT_2_4_ADDR A:0x6405b808
y.create.l HWIO_MSS_BAM_P_PSM_CNTXT_2_5_ADDR A:0x6405c808
y.create.l HWIO_MSS_BAM_P_PSM_CNTXT_3_0_ADDR A:0x6405780c
y.create.l HWIO_MSS_BAM_P_PSM_CNTXT_3_1_ADDR A:0x6405880c
y.create.l HWIO_MSS_BAM_P_PSM_CNTXT_3_2_ADDR A:0x6405980c
y.create.l HWIO_MSS_BAM_P_PSM_CNTXT_3_3_ADDR A:0x6405a80c
y.create.l HWIO_MSS_BAM_P_PSM_CNTXT_3_4_ADDR A:0x6405b80c
y.create.l HWIO_MSS_BAM_P_PSM_CNTXT_3_5_ADDR A:0x6405c80c
y.create.l HWIO_MSS_BAM_P_PSM_CNTXT_4_0_ADDR A:0x64057810
y.create.l HWIO_MSS_BAM_P_PSM_CNTXT_4_1_ADDR A:0x64058810
y.create.l HWIO_MSS_BAM_P_PSM_CNTXT_4_2_ADDR A:0x64059810
y.create.l HWIO_MSS_BAM_P_PSM_CNTXT_4_3_ADDR A:0x6405a810
y.create.l HWIO_MSS_BAM_P_PSM_CNTXT_4_4_ADDR A:0x6405b810
y.create.l HWIO_MSS_BAM_P_PSM_CNTXT_4_5_ADDR A:0x6405c810
y.create.l HWIO_MSS_BAM_P_PSM_CNTXT_5_0_ADDR A:0x64057814
y.create.l HWIO_MSS_BAM_P_PSM_CNTXT_5_1_ADDR A:0x64058814
y.create.l HWIO_MSS_BAM_P_PSM_CNTXT_5_2_ADDR A:0x64059814
y.create.l HWIO_MSS_BAM_P_PSM_CNTXT_5_3_ADDR A:0x6405a814
y.create.l HWIO_MSS_BAM_P_PSM_CNTXT_5_4_ADDR A:0x6405b814
y.create.l HWIO_MSS_BAM_P_PSM_CNTXT_5_5_ADDR A:0x6405c814
y.create.l HWIO_MSS_BAM_P_EVNT_REG0_ADDR A:0x64057818
y.create.l HWIO_MSS_BAM_P_EVNT_REG1_ADDR A:0x64058818
y.create.l HWIO_MSS_BAM_P_EVNT_REG2_ADDR A:0x64059818
y.create.l HWIO_MSS_BAM_P_EVNT_REG3_ADDR A:0x6405a818
y.create.l HWIO_MSS_BAM_P_EVNT_REG4_ADDR A:0x6405b818
y.create.l HWIO_MSS_BAM_P_EVNT_REG5_ADDR A:0x6405c818
y.create.l HWIO_MSS_BAM_P_DESC_FIFO_ADDR0_ADDR A:0x6405781c
y.create.l HWIO_MSS_BAM_P_DESC_FIFO_ADDR1_ADDR A:0x6405881c
y.create.l HWIO_MSS_BAM_P_DESC_FIFO_ADDR2_ADDR A:0x6405981c
y.create.l HWIO_MSS_BAM_P_DESC_FIFO_ADDR3_ADDR A:0x6405a81c
y.create.l HWIO_MSS_BAM_P_DESC_FIFO_ADDR4_ADDR A:0x6405b81c
y.create.l HWIO_MSS_BAM_P_DESC_FIFO_ADDR5_ADDR A:0x6405c81c
y.create.l HWIO_MSS_BAM_P_FIFO_SIZES0_ADDR A:0x64057820
y.create.l HWIO_MSS_BAM_P_FIFO_SIZES1_ADDR A:0x64058820
y.create.l HWIO_MSS_BAM_P_FIFO_SIZES2_ADDR A:0x64059820
y.create.l HWIO_MSS_BAM_P_FIFO_SIZES3_ADDR A:0x6405a820
y.create.l HWIO_MSS_BAM_P_FIFO_SIZES4_ADDR A:0x6405b820
y.create.l HWIO_MSS_BAM_P_FIFO_SIZES5_ADDR A:0x6405c820
y.create.l HWIO_MSS_BAM_P_DATA_FIFO_ADDR0_ADDR A:0x64057824
y.create.l HWIO_MSS_BAM_P_DATA_FIFO_ADDR1_ADDR A:0x64058824
y.create.l HWIO_MSS_BAM_P_DATA_FIFO_ADDR2_ADDR A:0x64059824
y.create.l HWIO_MSS_BAM_P_DATA_FIFO_ADDR3_ADDR A:0x6405a824
y.create.l HWIO_MSS_BAM_P_DATA_FIFO_ADDR4_ADDR A:0x6405b824
y.create.l HWIO_MSS_BAM_P_DATA_FIFO_ADDR5_ADDR A:0x6405c824
y.create.l HWIO_MSS_BAM_P_EVNT_GEN_TRSHLD0_ADDR A:0x64057828
y.create.l HWIO_MSS_BAM_P_EVNT_GEN_TRSHLD1_ADDR A:0x64058828
y.create.l HWIO_MSS_BAM_P_EVNT_GEN_TRSHLD2_ADDR A:0x64059828
y.create.l HWIO_MSS_BAM_P_EVNT_GEN_TRSHLD3_ADDR A:0x6405a828
y.create.l HWIO_MSS_BAM_P_EVNT_GEN_TRSHLD4_ADDR A:0x6405b828
y.create.l HWIO_MSS_BAM_P_EVNT_GEN_TRSHLD5_ADDR A:0x6405c828
y.create.l HWIO_MSS_BAM_P_EVNT_DEST_ADDR0_ADDR A:0x6405782c
y.create.l HWIO_MSS_BAM_P_EVNT_DEST_ADDR1_ADDR A:0x6405882c
y.create.l HWIO_MSS_BAM_P_EVNT_DEST_ADDR2_ADDR A:0x6405982c
y.create.l HWIO_MSS_BAM_P_EVNT_DEST_ADDR3_ADDR A:0x6405a82c
y.create.l HWIO_MSS_BAM_P_EVNT_DEST_ADDR4_ADDR A:0x6405b82c
y.create.l HWIO_MSS_BAM_P_EVNT_DEST_ADDR5_ADDR A:0x6405c82c
y.create.l HWIO_MSS_BAM_P_DF_CNTXT_0_ADDR A:0x64057830
y.create.l HWIO_MSS_BAM_P_DF_CNTXT_1_ADDR A:0x64058830
y.create.l HWIO_MSS_BAM_P_DF_CNTXT_2_ADDR A:0x64059830
y.create.l HWIO_MSS_BAM_P_DF_CNTXT_3_ADDR A:0x6405a830
y.create.l HWIO_MSS_BAM_P_DF_CNTXT_4_ADDR A:0x6405b830
y.create.l HWIO_MSS_BAM_P_DF_CNTXT_5_ADDR A:0x6405c830
y.create.l HWIO_MSS_BAM_P_RETR_CNTXT_0_ADDR A:0x64057834
y.create.l HWIO_MSS_BAM_P_RETR_CNTXT_1_ADDR A:0x64058834
y.create.l HWIO_MSS_BAM_P_RETR_CNTXT_2_ADDR A:0x64059834
y.create.l HWIO_MSS_BAM_P_RETR_CNTXT_3_ADDR A:0x6405a834
y.create.l HWIO_MSS_BAM_P_RETR_CNTXT_4_ADDR A:0x6405b834
y.create.l HWIO_MSS_BAM_P_RETR_CNTXT_5_ADDR A:0x6405c834
y.create.l HWIO_MSS_BAM_P_SI_CNTXT_0_ADDR A:0x64057838
y.create.l HWIO_MSS_BAM_P_SI_CNTXT_1_ADDR A:0x64058838
y.create.l HWIO_MSS_BAM_P_SI_CNTXT_2_ADDR A:0x64059838
y.create.l HWIO_MSS_BAM_P_SI_CNTXT_3_ADDR A:0x6405a838
y.create.l HWIO_MSS_BAM_P_SI_CNTXT_4_ADDR A:0x6405b838
y.create.l HWIO_MSS_BAM_P_SI_CNTXT_5_ADDR A:0x6405c838
y.create.l HWIO_MSS_BAM_P_PSM_CNTXT_3_LSB0_ADDR A:0x64057900
y.create.l HWIO_MSS_BAM_P_PSM_CNTXT_3_LSB1_ADDR A:0x64058900
y.create.l HWIO_MSS_BAM_P_PSM_CNTXT_3_LSB2_ADDR A:0x64059900
y.create.l HWIO_MSS_BAM_P_PSM_CNTXT_3_LSB3_ADDR A:0x6405a900
y.create.l HWIO_MSS_BAM_P_PSM_CNTXT_3_LSB4_ADDR A:0x6405b900
y.create.l HWIO_MSS_BAM_P_PSM_CNTXT_3_LSB5_ADDR A:0x6405c900
y.create.l HWIO_MSS_BAM_P_PSM_CNTXT_3_MSB0_ADDR A:0x64057904
y.create.l HWIO_MSS_BAM_P_PSM_CNTXT_3_MSB1_ADDR A:0x64058904
y.create.l HWIO_MSS_BAM_P_PSM_CNTXT_3_MSB2_ADDR A:0x64059904
y.create.l HWIO_MSS_BAM_P_PSM_CNTXT_3_MSB3_ADDR A:0x6405a904
y.create.l HWIO_MSS_BAM_P_PSM_CNTXT_3_MSB4_ADDR A:0x6405b904
y.create.l HWIO_MSS_BAM_P_PSM_CNTXT_3_MSB5_ADDR A:0x6405c904
y.create.l HWIO_MSS_BAM_P_DESC_FIFO_ADDR_LSB0_ADDR A:0x64057910
y.create.l HWIO_MSS_BAM_P_DESC_FIFO_ADDR_LSB1_ADDR A:0x64058910
y.create.l HWIO_MSS_BAM_P_DESC_FIFO_ADDR_LSB2_ADDR A:0x64059910
y.create.l HWIO_MSS_BAM_P_DESC_FIFO_ADDR_LSB3_ADDR A:0x6405a910
y.create.l HWIO_MSS_BAM_P_DESC_FIFO_ADDR_LSB4_ADDR A:0x6405b910
y.create.l HWIO_MSS_BAM_P_DESC_FIFO_ADDR_LSB5_ADDR A:0x6405c910
y.create.l HWIO_MSS_BAM_P_DESC_FIFO_ADDR_MSB0_ADDR A:0x64057914
y.create.l HWIO_MSS_BAM_P_DESC_FIFO_ADDR_MSB1_ADDR A:0x64058914
y.create.l HWIO_MSS_BAM_P_DESC_FIFO_ADDR_MSB2_ADDR A:0x64059914
y.create.l HWIO_MSS_BAM_P_DESC_FIFO_ADDR_MSB3_ADDR A:0x6405a914
y.create.l HWIO_MSS_BAM_P_DESC_FIFO_ADDR_MSB4_ADDR A:0x6405b914
y.create.l HWIO_MSS_BAM_P_DESC_FIFO_ADDR_MSB5_ADDR A:0x6405c914
y.create.l HWIO_MSS_BAM_P_DATA_FIFO_ADDR_LSB0_ADDR A:0x64057920
y.create.l HWIO_MSS_BAM_P_DATA_FIFO_ADDR_LSB1_ADDR A:0x64058920
y.create.l HWIO_MSS_BAM_P_DATA_FIFO_ADDR_LSB2_ADDR A:0x64059920
y.create.l HWIO_MSS_BAM_P_DATA_FIFO_ADDR_LSB3_ADDR A:0x6405a920
y.create.l HWIO_MSS_BAM_P_DATA_FIFO_ADDR_LSB4_ADDR A:0x6405b920
y.create.l HWIO_MSS_BAM_P_DATA_FIFO_ADDR_LSB5_ADDR A:0x6405c920
y.create.l HWIO_MSS_BAM_P_DATA_FIFO_ADDR_MSB0_ADDR A:0x64057924
y.create.l HWIO_MSS_BAM_P_DATA_FIFO_ADDR_MSB1_ADDR A:0x64058924
y.create.l HWIO_MSS_BAM_P_DATA_FIFO_ADDR_MSB2_ADDR A:0x64059924
y.create.l HWIO_MSS_BAM_P_DATA_FIFO_ADDR_MSB3_ADDR A:0x6405a924
y.create.l HWIO_MSS_BAM_P_DATA_FIFO_ADDR_MSB4_ADDR A:0x6405b924
y.create.l HWIO_MSS_BAM_P_DATA_FIFO_ADDR_MSB5_ADDR A:0x6405c924
y.create.l HWIO_MSS_BAM_P_EVNT_DEST_ADDR_LSB0_ADDR A:0x64057930
y.create.l HWIO_MSS_BAM_P_EVNT_DEST_ADDR_LSB1_ADDR A:0x64058930
y.create.l HWIO_MSS_BAM_P_EVNT_DEST_ADDR_LSB2_ADDR A:0x64059930
y.create.l HWIO_MSS_BAM_P_EVNT_DEST_ADDR_LSB3_ADDR A:0x6405a930
y.create.l HWIO_MSS_BAM_P_EVNT_DEST_ADDR_LSB4_ADDR A:0x6405b930
y.create.l HWIO_MSS_BAM_P_EVNT_DEST_ADDR_LSB5_ADDR A:0x6405c930
y.create.l HWIO_MSS_BAM_P_EVNT_DEST_ADDR_MSB0_ADDR A:0x64057934
y.create.l HWIO_MSS_BAM_P_EVNT_DEST_ADDR_MSB1_ADDR A:0x64058934
y.create.l HWIO_MSS_BAM_P_EVNT_DEST_ADDR_MSB2_ADDR A:0x64059934
y.create.l HWIO_MSS_BAM_P_EVNT_DEST_ADDR_MSB3_ADDR A:0x6405a934
y.create.l HWIO_MSS_BAM_P_EVNT_DEST_ADDR_MSB4_ADDR A:0x6405b934
y.create.l HWIO_MSS_BAM_P_EVNT_DEST_ADDR_MSB5_ADDR A:0x6405c934
y.create.l HWIO_MSS_QDSP6SS_VERSION_ADDR A:0x64080000
y.create.l HWIO_MSS_QDSP6SS_CONFIG_ID_ADDR A:0x64080004
y.create.l HWIO_MSS_QDSP6SS_RST_EVB_ADDR A:0x64080010
y.create.l HWIO_MSS_QDSP6SS_RESET_ADDR A:0x64080014
y.create.l HWIO_MSS_QDSP6SS_DBG_CFG_ADDR A:0x64080018
y.create.l HWIO_MSS_QDSP6SS_RET_CFG_ADDR A:0x6408001c
y.create.l HWIO_MSS_QDSP6SS_GFMUX_CTL_ADDR A:0x64080020
y.create.l HWIO_MSS_QDSP6SS_GFMUX_STATUS_ADDR A:0x64080024
y.create.l HWIO_MSS_QDSP6SS_CORE_CMD_RCGR_ADDR A:0x64080028
y.create.l HWIO_MSS_QDSP6SS_CORE_CFG_RCGR_ADDR A:0x6408002c
y.create.l HWIO_MSS_QDSP6SS_PWR_CTL_ADDR A:0x64080030
y.create.l HWIO_MSS_QDSP6SS_CGC_OVERRIDE_ADDR A:0x64080034
y.create.l HWIO_MSS_QDSP6SS_XO_CBCR_ADDR A:0x64080038
y.create.l HWIO_MSS_QDSP6SS_SLEEP_CBCR_ADDR A:0x6408003c
y.create.l HWIO_MSS_QDSP6SS_NMI_ADDR A:0x64080040
y.create.l HWIO_MSS_QDSP6SS_NMI_STATUS_ADDR A:0x64080044
y.create.l HWIO_MSS_QDSP6SS_CLOCK_SPDM_MON_ADDR A:0x64080048
y.create.l HWIO_MSS_QDSP6SS_STATERET_CTL_ADDR A:0x6408004c
y.create.l HWIO_MSS_QDSP6SS_BHS_CTL_ADDR A:0x64080074
y.create.l HWIO_MSS_QDSP6SS_BHS_STATUS_ADDR A:0x64080078
y.create.l HWIO_MSS_QDSP6SS_QMC_SVS_CTL_ADDR A:0x6408007c
y.create.l HWIO_MSS_QDSP6SS_SPM_SW_TRIG_ADDR A:0x64080080
y.create.l HWIO_MSS_QDSP6SS_SPM_TRIG_STATUS_ADDR A:0x64080084
y.create.l HWIO_MSS_QDSP6SS_INTF_HALTREQ_ADDR A:0x64080088
y.create.l HWIO_MSS_QDSP6SS_INTF_HALTACK_ADDR A:0x6408008c
y.create.l HWIO_MSS_QDSP6SS_INTFCLAMP_SET_ADDR A:0x64080090
y.create.l HWIO_MSS_QDSP6SS_INTFCLAMP_CLEAR_ADDR A:0x64080094
y.create.l HWIO_MSS_QDSP6SS_INTFCLAMP_STATUS_ADDR A:0x64080098
y.create.l HWIO_MSS_QDSP6SS_INTF_FIFO_RESET_ADDR A:0x640800a0
y.create.l HWIO_MSS_QDSP6SS_MEM_PWR_CTL_ADDR A:0x640800b0
y.create.l HWIO_MSS_QDSP6SS_L1S_PWR_CTL_ADDR A:0x640800b4
y.create.l HWIO_MSS_QDSP6SS_L1S2_PWR_CTL_ADDR A:0x640800b8
y.create.l HWIO_MSS_QDSP6SS_CP_PWR_CTL_ADDR A:0x640800c0
y.create.l HWIO_MSS_QDSP6SS_CP_PWR_STATUS_ADDR A:0x640800c4
y.create.l HWIO_MSS_QDSP6SS_CP_RESET_ADDR A:0x640800c8
y.create.l HWIO_MSS_QDSP6SS_CP_CLK_CTL_ADDR A:0x640800cc
y.create.l HWIO_MSS_QDSP6SS_CP2_PWR_CTL_ADDR A:0x640800d0
y.create.l HWIO_MSS_QDSP6SS_CP2_PWR_STATUS_ADDR A:0x640800d4
y.create.l HWIO_MSS_QDSP6SS_CP2_RESET_ADDR A:0x640800d8
y.create.l HWIO_MSS_QDSP6SS_CP2_CLK_CTL_ADDR A:0x640800dc
y.create.l HWIO_MSS_QDSP6SS_STRAP_TCM_ADDR A:0x64080100
y.create.l HWIO_MSS_QDSP6SS_STRAP_AHBUPPER_ADDR A:0x64080104
y.create.l HWIO_MSS_QDSP6SS_STRAP_AHBLOWER_ADDR A:0x64080108
y.create.l HWIO_MSS_QDSP6SS_STRAP_ACC_ADDR A:0x64080110
y.create.l HWIO_MSS_QDSP6SS_STRAP_QMC_ACC_ADDR A:0x64080114
y.create.l HWIO_MSS_QDSP6SS_DCC_CTRL_ADDR A:0x64080118
y.create.l HWIO_MSS_QDSP6SS_STRAP_AXIM2UPPER_ADDR A:0x6408011c
y.create.l HWIO_MSS_QDSP6SS_STRAP_AXIM2LOWER_ADDR A:0x64080120
y.create.l HWIO_MSS_QDSP6SS_PLL_MODE_ADDR A:0x64080200
y.create.l HWIO_MSS_QDSP6SS_PLL_L_VAL_ADDR A:0x64080204
y.create.l HWIO_MSS_QDSP6SS_PLL_ALPHA_VAL_ADDR A:0x64080208
y.create.l HWIO_MSS_QDSP6SS_PLL_ALPHA_VAL_U_ADDR A:0x6408020c
y.create.l HWIO_MSS_QDSP6SS_PLL_USER_CTL_ADDR A:0x64080210
y.create.l HWIO_MSS_QDSP6SS_PLL_USER_CTL_U_ADDR A:0x64080214
y.create.l HWIO_MSS_QDSP6SS_PLL_CONFIG_CTL_ADDR A:0x64080218
y.create.l HWIO_MSS_QDSP6SS_PLL_TEST_CTL_ADDR A:0x6408021c
y.create.l HWIO_MSS_QDSP6SS_PLL_TEST_CTL_U_ADDR A:0x64080220
y.create.l HWIO_MSS_QDSP6SS_PLL_STATUS_ADDR A:0x64080224
y.create.l HWIO_MSS_QDSP6SS_PLL_FREQ_CTL_ADDR A:0x64080228
y.create.l HWIO_MSS_QDSP6SS_PLL_RCG_UPDATE_CFG_ADDR A:0x64080240
y.create.l HWIO_MSS_QDSP6SS_PLL_RCG_UPDATE_DLYCTL_ADDR A:0x64080244
y.create.l HWIO_MSS_QDSP6SS_PLL_RCG_UPDATE_CMD_ADDR A:0x64080248
y.create.l HWIO_MSS_QDSP6SS_PLL_RCG_UPDATE_STATUS_ADDR A:0x6408023c
y.create.l HWIO_MSS_QDSP6SS_EXT_WAKEUP_ADDR A:0x64081000
y.create.l HWIO_MSS_QDSP6SS_EXT_PD_ADDR A:0x64081004
y.create.l HWIO_MSS_QDSP6SS_TEST_BUS_CTL_ADDR A:0x64082000
y.create.l HWIO_MSS_QDSP6SS_TEST_BUS_VALUE_ADDR A:0x64082004
y.create.l HWIO_MSS_QDSP6SS_TEST_BUS_WDATA_ADDR A:0x64082008
y.create.l HWIO_MSS_QDSP6SS_PWRDBG_CTL_ADDR A:0x6408200c
y.create.l HWIO_MSS_QDSP6SS_TEST_CLK_CTL_ADDR A:0x64082010
y.create.l HWIO_MSS_QDSP6SS_PWRDBG_STATUS_ADDR A:0x64082014
y.create.l HWIO_MSS_QDSP6SS_ZMEAS_CONFIG_ADDR A:0x64082018
y.create.l HWIO_MSS_QDSP6SS_CORE_STATUS_ADDR A:0x64082028
y.create.l HWIO_QDSP6SS_INSTANCE_ID_ADDR A:0x64100000
y.create.l HWIO_QDSP6SS_IDLT_MATCH_VAL_ADDR A:0x64101000
y.create.l HWIO_QDSP6SS_IDLT_COUNT_VAL_ADDR A:0x64101004
y.create.l HWIO_QDSP6SS_IDLT_ENABLE_ADDR A:0x64101008
y.create.l HWIO_QDSP6SS_IDLT_SYNC_STATUS_ADDR A:0x6410100c
y.create.l HWIO_QDSP6SS_WDOG_RESET_ADDR A:0x64102000
y.create.l HWIO_QDSP6SS_WDOG_CTL_ADDR A:0x64102004
y.create.l HWIO_QDSP6SS_WDOG_STATUS_ADDR A:0x64102008
y.create.l HWIO_QDSP6SS_WDOG_BARK_TIME_ADDR A:0x6410200c
y.create.l HWIO_QDSP6SS_WDOG_BITE_TIME_ADDR A:0x64102010
y.create.l HWIO_QDSP6SS_WDOG_NMI_TIME_ADDR A:0x64102014
y.create.l HWIO_QDSP6SS_WDOG_TEST_LOAD_ADDR A:0x64102018
y.create.l HWIO_QDSP6SS_WDOG_TEST_ADDR A:0x6410201c
y.create.l HWIO_QDSP6SS_IPC_ADDR A:0x64105000
y.create.l HWIO_QDSP6SS_IPC1_ADDR A:0x64105004
y.create.l HWIO_QDSP6SS_BLOCK_INTR_ADDR A:0x64107008
y.create.l HWIO_QDSP6SS_PD_HS_START_ADDR A:0x6410700c
y.create.l HWIO_QDSP6SS_PD_HS_DONE_ADDR A:0x64107010
y.create.l HWIO_QDSP6SS_PU_HS_START_ADDR A:0x64107014
y.create.l HWIO_QDSP6SS_SLPC_CFG_ADDR A:0x6410701c
y.create.l HWIO_QDSP6SS_SLPC_STATUS_ADDR A:0x64107020
y.create.l HWIO_QDSP6SS_L2VIC_WAKEUP_EN_ADDR A:0x64107028
y.create.l HWIO_QDSP6SS_MVC_PWR_REQ_ADDR A:0x64107030
y.create.l HWIO_QDSP6SS_SPM_EVENT_CTL_ADDR A:0x64107050
y.create.l HWIO_QDSP6SS_SPM_TRIG_CFG0_ADDR A:0x64107080
y.create.l HWIO_QDSP6SS_SPM_TRIG_CFG1_ADDR A:0x64107084
y.create.l HWIO_QDSP6SS_SPMCTL_EN_ARES_ADDR A:0x64107100
y.create.l HWIO_QDSP6SS_SPMCTL_EN_CLAMP_ADDR A:0x64107104
y.create.l HWIO_QDSP6SS_SPMCTL_EN_CLK_ADDR A:0x64107108
y.create.l HWIO_QDSP6SS_SPMCTL_EN_MEM_ADDR A:0x6410710c
y.create.l HWIO_QDSP6SS_SPMCTL_EN_BHS_ADDR A:0x64107114
y.create.l HWIO_QDSP6SS_SPMCTL_EN_LDO_ADDR A:0x64107118
y.create.l HWIO_QDSP6SS_SPMCTL_EN_EXT_ADDR A:0x6410711c
y.create.l HWIO_QDSP6SS_SPMCTL_EN_PLL_ADDR A:0x64107120
y.create.l HWIO_QDSP6SS_SPMCTL_EN_STATERET_ADDR A:0x64107124
y.create.l HWIO_QDSP6SS_SPMCTL_EN_ISOINTF_CTL_ADDR A:0x64107128
y.create.l HWIO_QDSP6SS_SPMCTL_EN_ISOINTF_CLAMP_ADDR A:0x6410712c
y.create.l HWIO_QDSP6SS_SPMCTL_EN_ISOINTF_CLK_ADDR A:0x64107130
y.create.l HWIO_QDSP6SS_SPMCTL_EN_MEM_L1S_ADDR A:0x64107140
y.create.l HWIO_QDSP6SS_SPMCTL_EN_ARES_SET_ADDR A:0x64107180
y.create.l HWIO_QDSP6SS_SPMCTL_EN_CLAMP_SET_ADDR A:0x64107184
y.create.l HWIO_QDSP6SS_SPMCTL_EN_CLK_SET_ADDR A:0x64107188
y.create.l HWIO_QDSP6SS_SPMCTL_EN_MEM_SET_ADDR A:0x6410718c
y.create.l HWIO_QDSP6SS_SPMCTL_EN_BHS_SET_ADDR A:0x64107194
y.create.l HWIO_QDSP6SS_SPMCTL_EN_LDO_SET_ADDR A:0x64107198
y.create.l HWIO_QDSP6SS_SPMCTL_EN_EXT_SET_ADDR A:0x6410719c
y.create.l HWIO_QDSP6SS_SPMCTL_EN_PLL_SET_ADDR A:0x641071a0
y.create.l HWIO_QDSP6SS_SPMCTL_EN_STATERET_SET_ADDR A:0x641071a4
y.create.l HWIO_QDSP6SS_SPMCTL_EN_ISOINTF_CTL_SET_ADDR A:0x641071a8
y.create.l HWIO_QDSP6SS_SPMCTL_EN_ISOINTF_CLAMP_SET_ADDR A:0x641071ac
y.create.l HWIO_QDSP6SS_SPMCTL_EN_ISOINTF_CLK_SET_ADDR A:0x641071b0
y.create.l HWIO_QDSP6SS_SPMCTL_EN_MEM_L1S_SET_ADDR A:0x641071c0
y.create.l HWIO_QDSP6SS_SPMCTL_EN_ARES_CLEAR_ADDR A:0x64107200
y.create.l HWIO_QDSP6SS_SPMCTL_EN_CLAMP_CLEAR_ADDR A:0x64107204
y.create.l HWIO_QDSP6SS_SPMCTL_EN_CLK_CLEAR_ADDR A:0x64107208
y.create.l HWIO_QDSP6SS_SPMCTL_EN_MEM_CLEAR_ADDR A:0x6410720c
y.create.l HWIO_QDSP6SS_SPMCTL_EN_BHS_CLEAR_ADDR A:0x64107214
y.create.l HWIO_QDSP6SS_SPMCTL_EN_LDO_CLEAR_ADDR A:0x64107218
y.create.l HWIO_QDSP6SS_SPMCTL_EN_EXT_CLEAR_ADDR A:0x6410721c
y.create.l HWIO_QDSP6SS_SPMCTL_EN_PLL_CLEAR_ADDR A:0x64107220
y.create.l HWIO_QDSP6SS_SPMCTL_EN_STATERET_CLEAR_ADDR A:0x64107224
y.create.l HWIO_QDSP6SS_SPMCTL_EN_ISOINTF_CTL_CLEAR_ADDR A:0x64107228
y.create.l HWIO_QDSP6SS_SPMCTL_EN_ISOINTF_CLAMP_CLEAR_ADDR A:0x6410722c
y.create.l HWIO_QDSP6SS_SPMCTL_EN_ISOINTF_CLK_CLEAR_ADDR A:0x64107230
y.create.l HWIO_QDSP6SS_SPMCTL_EN_MEM_L1S_CLEAR_ADDR A:0x64107240
y.create.l HWIO_QDSP6SS_L2VIC_VID_ADDR A:0x64110000
y.create.l HWIO_QDSP6SS_L2VIC_INT_ENABLE0_ADDR A:0x64110100
y.create.l HWIO_QDSP6SS_L2VIC_INT_ENABLE1_ADDR A:0x64110104
y.create.l HWIO_QDSP6SS_L2VIC_INT_ENABLE2_ADDR A:0x64110108
y.create.l HWIO_QDSP6SS_L2VIC_INT_ENABLE3_ADDR A:0x6411010c
y.create.l HWIO_QDSP6SS_L2VIC_INT_ENABLE4_ADDR A:0x64110110
y.create.l HWIO_QDSP6SS_L2VIC_INT_ENABLE5_ADDR A:0x64110114
y.create.l HWIO_QDSP6SS_L2VIC_INT_ENABLE6_ADDR A:0x64110118
y.create.l HWIO_QDSP6SS_L2VIC_INT_ENABLE7_ADDR A:0x6411011c
y.create.l HWIO_QDSP6SS_L2VIC_INT_ENABLE8_ADDR A:0x64110120
y.create.l HWIO_QDSP6SS_L2VIC_INT_ENABLE9_ADDR A:0x64110124
y.create.l HWIO_QDSP6SS_L2VIC_INT_ENABLE_CLEAR0_ADDR A:0x64110180
y.create.l HWIO_QDSP6SS_L2VIC_INT_ENABLE_CLEAR1_ADDR A:0x64110184
y.create.l HWIO_QDSP6SS_L2VIC_INT_ENABLE_CLEAR2_ADDR A:0x64110188
y.create.l HWIO_QDSP6SS_L2VIC_INT_ENABLE_CLEAR3_ADDR A:0x6411018c
y.create.l HWIO_QDSP6SS_L2VIC_INT_ENABLE_CLEAR4_ADDR A:0x64110190
y.create.l HWIO_QDSP6SS_L2VIC_INT_ENABLE_CLEAR5_ADDR A:0x64110194
y.create.l HWIO_QDSP6SS_L2VIC_INT_ENABLE_CLEAR6_ADDR A:0x64110198
y.create.l HWIO_QDSP6SS_L2VIC_INT_ENABLE_CLEAR7_ADDR A:0x6411019c
y.create.l HWIO_QDSP6SS_L2VIC_INT_ENABLE_CLEAR8_ADDR A:0x641101a0
y.create.l HWIO_QDSP6SS_L2VIC_INT_ENABLE_CLEAR9_ADDR A:0x641101a4
y.create.l HWIO_QDSP6SS_L2VIC_INT_ENABLE_SET0_ADDR A:0x64110200
y.create.l HWIO_QDSP6SS_L2VIC_INT_ENABLE_SET1_ADDR A:0x64110204
y.create.l HWIO_QDSP6SS_L2VIC_INT_ENABLE_SET2_ADDR A:0x64110208
y.create.l HWIO_QDSP6SS_L2VIC_INT_ENABLE_SET3_ADDR A:0x6411020c
y.create.l HWIO_QDSP6SS_L2VIC_INT_ENABLE_SET4_ADDR A:0x64110210
y.create.l HWIO_QDSP6SS_L2VIC_INT_ENABLE_SET5_ADDR A:0x64110214
y.create.l HWIO_QDSP6SS_L2VIC_INT_ENABLE_SET6_ADDR A:0x64110218
y.create.l HWIO_QDSP6SS_L2VIC_INT_ENABLE_SET7_ADDR A:0x6411021c
y.create.l HWIO_QDSP6SS_L2VIC_INT_ENABLE_SET8_ADDR A:0x64110220
y.create.l HWIO_QDSP6SS_L2VIC_INT_ENABLE_SET9_ADDR A:0x64110224
y.create.l HWIO_QDSP6SS_L2VIC_INT_TYPE0_ADDR A:0x64110280
y.create.l HWIO_QDSP6SS_L2VIC_INT_TYPE1_ADDR A:0x64110284
y.create.l HWIO_QDSP6SS_L2VIC_INT_TYPE2_ADDR A:0x64110288
y.create.l HWIO_QDSP6SS_L2VIC_INT_TYPE3_ADDR A:0x6411028c
y.create.l HWIO_QDSP6SS_L2VIC_INT_TYPE4_ADDR A:0x64110290
y.create.l HWIO_QDSP6SS_L2VIC_INT_TYPE5_ADDR A:0x64110294
y.create.l HWIO_QDSP6SS_L2VIC_INT_TYPE6_ADDR A:0x64110298
y.create.l HWIO_QDSP6SS_L2VIC_INT_TYPE7_ADDR A:0x6411029c
y.create.l HWIO_QDSP6SS_L2VIC_INT_TYPE8_ADDR A:0x641102a0
y.create.l HWIO_QDSP6SS_L2VIC_INT_TYPE9_ADDR A:0x641102a4
y.create.l HWIO_QDSP6SS_L2VIC_INT_STATUS0_ADDR A:0x64110380
y.create.l HWIO_QDSP6SS_L2VIC_INT_STATUS1_ADDR A:0x64110384
y.create.l HWIO_QDSP6SS_L2VIC_INT_STATUS2_ADDR A:0x64110388
y.create.l HWIO_QDSP6SS_L2VIC_INT_STATUS3_ADDR A:0x6411038c
y.create.l HWIO_QDSP6SS_L2VIC_INT_STATUS4_ADDR A:0x64110390
y.create.l HWIO_QDSP6SS_L2VIC_INT_STATUS5_ADDR A:0x64110394
y.create.l HWIO_QDSP6SS_L2VIC_INT_STATUS6_ADDR A:0x64110398
y.create.l HWIO_QDSP6SS_L2VIC_INT_STATUS7_ADDR A:0x6411039c
y.create.l HWIO_QDSP6SS_L2VIC_INT_STATUS8_ADDR A:0x641103a0
y.create.l HWIO_QDSP6SS_L2VIC_INT_STATUS9_ADDR A:0x641103a4
y.create.l HWIO_QDSP6SS_L2VIC_INT_CLEAR0_ADDR A:0x64110400
y.create.l HWIO_QDSP6SS_L2VIC_INT_CLEAR1_ADDR A:0x64110404
y.create.l HWIO_QDSP6SS_L2VIC_INT_CLEAR2_ADDR A:0x64110408
y.create.l HWIO_QDSP6SS_L2VIC_INT_CLEAR3_ADDR A:0x6411040c
y.create.l HWIO_QDSP6SS_L2VIC_INT_CLEAR4_ADDR A:0x64110410
y.create.l HWIO_QDSP6SS_L2VIC_INT_CLEAR5_ADDR A:0x64110414
y.create.l HWIO_QDSP6SS_L2VIC_INT_CLEAR6_ADDR A:0x64110418
y.create.l HWIO_QDSP6SS_L2VIC_INT_CLEAR7_ADDR A:0x6411041c
y.create.l HWIO_QDSP6SS_L2VIC_INT_CLEAR8_ADDR A:0x64110420
y.create.l HWIO_QDSP6SS_L2VIC_INT_CLEAR9_ADDR A:0x64110424
y.create.l HWIO_QDSP6SS_L2VIC_SOFT_INT0_ADDR A:0x64110480
y.create.l HWIO_QDSP6SS_L2VIC_SOFT_INT1_ADDR A:0x64110484
y.create.l HWIO_QDSP6SS_L2VIC_SOFT_INT2_ADDR A:0x64110488
y.create.l HWIO_QDSP6SS_L2VIC_SOFT_INT3_ADDR A:0x6411048c
y.create.l HWIO_QDSP6SS_L2VIC_SOFT_INT4_ADDR A:0x64110490
y.create.l HWIO_QDSP6SS_L2VIC_SOFT_INT5_ADDR A:0x64110494
y.create.l HWIO_QDSP6SS_L2VIC_SOFT_INT6_ADDR A:0x64110498
y.create.l HWIO_QDSP6SS_L2VIC_SOFT_INT7_ADDR A:0x6411049c
y.create.l HWIO_QDSP6SS_L2VIC_SOFT_INT8_ADDR A:0x641104a0
y.create.l HWIO_QDSP6SS_L2VIC_SOFT_INT9_ADDR A:0x641104a4
y.create.l HWIO_QDSP6SS_L2VIC_INT_PENDING0_ADDR A:0x64110500
y.create.l HWIO_QDSP6SS_L2VIC_INT_PENDING1_ADDR A:0x64110504
y.create.l HWIO_QDSP6SS_L2VIC_INT_PENDING2_ADDR A:0x64110508
y.create.l HWIO_QDSP6SS_L2VIC_INT_PENDING3_ADDR A:0x6411050c
y.create.l HWIO_QDSP6SS_L2VIC_INT_PENDING4_ADDR A:0x64110510
y.create.l HWIO_QDSP6SS_L2VIC_INT_PENDING5_ADDR A:0x64110514
y.create.l HWIO_QDSP6SS_L2VIC_INT_PENDING6_ADDR A:0x64110518
y.create.l HWIO_QDSP6SS_L2VIC_INT_PENDING7_ADDR A:0x6411051c
y.create.l HWIO_QDSP6SS_L2VIC_INT_PENDING8_ADDR A:0x64110520
y.create.l HWIO_QDSP6SS_L2VIC_INT_PENDING9_ADDR A:0x64110524
y.create.l HWIO_QDSP6SS_QTMR_AC_CNTFRQ_ADDR A:0x64120000
y.create.l HWIO_QDSP6SS_QTMR_AC_CNTSR_ADDR A:0x64120004
y.create.l HWIO_QDSP6SS_QTMR_AC_CNTTID_ADDR A:0x64120008
y.create.l HWIO_QDSP6SS_QTMR_AC_CNTACR_0_ADDR A:0x64120040
y.create.l HWIO_QDSP6SS_QTMR_AC_CNTACR_1_ADDR A:0x64120044
y.create.l HWIO_QDSP6SS_QTMR_AC_CNTACR_2_ADDR A:0x64120048
y.create.l HWIO_QDSP6SS_QTMR_AC_CNTVOFF_LO_0_ADDR A:0x64120080
y.create.l HWIO_QDSP6SS_QTMR_AC_CNTVOFF_LO_1_ADDR A:0x64120088
y.create.l HWIO_QDSP6SS_QTMR_AC_CNTVOFF_LO_2_ADDR A:0x64120090
y.create.l HWIO_QDSP6SS_QTMR_AC_CNTVOFF_HI_0_ADDR A:0x64120084
y.create.l HWIO_QDSP6SS_QTMR_AC_CNTVOFF_HI_1_ADDR A:0x6412008c
y.create.l HWIO_QDSP6SS_QTMR_AC_CNTVOFF_HI_2_ADDR A:0x64120094
y.create.l HWIO_QDSP6SS_QTMR_AC_CFG_ADDR A:0x64120fc0
y.create.l HWIO_QDSP6SS_QTMR_AC_VERSION_ADDR A:0x64120fd0
y.create.l HWIO_QDSP6SS_QTMR_V1_CNTPCT_LO_0_ADDR A:0x64121000
y.create.l HWIO_QDSP6SS_QTMR_V1_CNTPCT_HI_0_ADDR A:0x64121004
y.create.l HWIO_QDSP6SS_QTMR_V1_CNTVCT_LO_0_ADDR A:0x64121008
y.create.l HWIO_QDSP6SS_QTMR_V1_CNTVCT_HI_0_ADDR A:0x6412100c
y.create.l HWIO_QDSP6SS_QTMR_V1_CNTFRQ_0_ADDR A:0x64121010
y.create.l HWIO_QDSP6SS_QTMR_V1_CNTPL0ACR_0_ADDR A:0x64121014
y.create.l HWIO_QDSP6SS_QTMR_V1_CNTVOFF_LO_0_ADDR A:0x64121018
y.create.l HWIO_QDSP6SS_QTMR_V1_CNTVOFF_HI_0_ADDR A:0x6412101c
y.create.l HWIO_QDSP6SS_QTMR_V1_CNTP_CVAL_LO_0_ADDR A:0x64121020
y.create.l HWIO_QDSP6SS_QTMR_V1_CNTP_CVAL_HI_0_ADDR A:0x64121024
y.create.l HWIO_QDSP6SS_QTMR_V1_CNTP_TVAL_0_ADDR A:0x64121028
y.create.l HWIO_QDSP6SS_QTMR_V1_CNTP_CTL_0_ADDR A:0x6412102c
y.create.l HWIO_QDSP6SS_QTMR_V1_CNTV_CVAL_LO_0_ADDR A:0x64121030
y.create.l HWIO_QDSP6SS_QTMR_V1_CNTV_CVAL_HI_0_ADDR A:0x64121034
y.create.l HWIO_QDSP6SS_QTMR_V1_CNTV_TVAL_0_ADDR A:0x64121038
y.create.l HWIO_QDSP6SS_QTMR_V1_CNTV_CTL_0_ADDR A:0x6412103c
y.create.l HWIO_QDSP6SS_QTMR_V1_VERSION_0_ADDR A:0x64121fd0
y.create.l HWIO_QDSP6SS_QTMR_V1_CNTPCT_LO_1_ADDR A:0x64122000
y.create.l HWIO_QDSP6SS_QTMR_V1_CNTPCT_HI_1_ADDR A:0x64122004
y.create.l HWIO_QDSP6SS_QTMR_V1_CNTVCT_LO_1_ADDR A:0x64122008
y.create.l HWIO_QDSP6SS_QTMR_V1_CNTVCT_HI_1_ADDR A:0x6412200c
y.create.l HWIO_QDSP6SS_QTMR_V1_CNTFRQ_1_ADDR A:0x64122010
y.create.l HWIO_QDSP6SS_QTMR_V1_CNTPL0ACR_1_ADDR A:0x64122014
y.create.l HWIO_QDSP6SS_QTMR_V1_CNTVOFF_LO_1_ADDR A:0x64122018
y.create.l HWIO_QDSP6SS_QTMR_V1_CNTVOFF_HI_1_ADDR A:0x6412201c
y.create.l HWIO_QDSP6SS_QTMR_V1_CNTP_CVAL_LO_1_ADDR A:0x64122020
y.create.l HWIO_QDSP6SS_QTMR_V1_CNTP_CVAL_HI_1_ADDR A:0x64122024
y.create.l HWIO_QDSP6SS_QTMR_V1_CNTP_TVAL_1_ADDR A:0x64122028
y.create.l HWIO_QDSP6SS_QTMR_V1_CNTP_CTL_1_ADDR A:0x6412202c
y.create.l HWIO_QDSP6SS_QTMR_V1_CNTV_CVAL_LO_1_ADDR A:0x64122030
y.create.l HWIO_QDSP6SS_QTMR_V1_CNTV_CVAL_HI_1_ADDR A:0x64122034
y.create.l HWIO_QDSP6SS_QTMR_V1_CNTV_TVAL_1_ADDR A:0x64122038
y.create.l HWIO_QDSP6SS_QTMR_V1_CNTV_CTL_1_ADDR A:0x6412203c
y.create.l HWIO_QDSP6SS_QTMR_V1_VERSION_1_ADDR A:0x64122fd0
y.create.l HWIO_QDSP6SS_QTMR_V1_CNTPCT_LO_2_ADDR A:0x64123000
y.create.l HWIO_QDSP6SS_QTMR_V1_CNTPCT_HI_2_ADDR A:0x64123004
y.create.l HWIO_QDSP6SS_QTMR_V1_CNTVCT_LO_2_ADDR A:0x64123008
y.create.l HWIO_QDSP6SS_QTMR_V1_CNTVCT_HI_2_ADDR A:0x6412300c
y.create.l HWIO_QDSP6SS_QTMR_V1_CNTFRQ_2_ADDR A:0x64123010
y.create.l HWIO_QDSP6SS_QTMR_V1_CNTPL0ACR_2_ADDR A:0x64123014
y.create.l HWIO_QDSP6SS_QTMR_V1_CNTVOFF_LO_2_ADDR A:0x64123018
y.create.l HWIO_QDSP6SS_QTMR_V1_CNTVOFF_HI_2_ADDR A:0x6412301c
y.create.l HWIO_QDSP6SS_QTMR_V1_CNTP_CVAL_LO_2_ADDR A:0x64123020
y.create.l HWIO_QDSP6SS_QTMR_V1_CNTP_CVAL_HI_2_ADDR A:0x64123024
y.create.l HWIO_QDSP6SS_QTMR_V1_CNTP_TVAL_2_ADDR A:0x64123028
y.create.l HWIO_QDSP6SS_QTMR_V1_CNTP_CTL_2_ADDR A:0x6412302c
y.create.l HWIO_QDSP6SS_QTMR_V1_CNTV_CVAL_LO_2_ADDR A:0x64123030
y.create.l HWIO_QDSP6SS_QTMR_V1_CNTV_CVAL_HI_2_ADDR A:0x64123034
y.create.l HWIO_QDSP6SS_QTMR_V1_CNTV_TVAL_2_ADDR A:0x64123038
y.create.l HWIO_QDSP6SS_QTMR_V1_CNTV_CTL_2_ADDR A:0x6412303c
y.create.l HWIO_QDSP6SS_QTMR_V1_VERSION_2_ADDR A:0x64123fd0
y.create.l HWIO_QDSP6SS_SAW2_SECURE_ADDR A:0x64130000
y.create.l HWIO_QDSP6SS_SAW2_ID_ADDR A:0x64130004
y.create.l HWIO_QDSP6SS_SAW2_CFG_ADDR A:0x64130008
y.create.l HWIO_QDSP6SS_SAW2_SPM_STS_ADDR A:0x6413000c
y.create.l HWIO_QDSP6SS_SAW2_AVS_STS_ADDR A:0x64130010
y.create.l HWIO_QDSP6SS_SAW2_PMIC_STS_ADDR A:0x64130014
y.create.l HWIO_QDSP6SS_SAW2_RST_ADDR A:0x64130018
y.create.l HWIO_QDSP6SS_SAW2_VCTL_ADDR A:0x6413001c
y.create.l HWIO_QDSP6SS_SAW2_AVS_CTL_ADDR A:0x64130020
y.create.l HWIO_QDSP6SS_SAW2_AVS_LIMIT_ADDR A:0x64130024
y.create.l HWIO_QDSP6SS_SAW2_AVS_DLY_ADDR A:0x64130028
y.create.l HWIO_QDSP6SS_SAW2_AVS_HYSTERESIS_ADDR A:0x6413002c
y.create.l HWIO_QDSP6SS_SAW2_SPM_CTL_ADDR A:0x64130030
y.create.l HWIO_QDSP6SS_SAW2_SPM_DLY_ADDR A:0x64130034
y.create.l HWIO_QDSP6SS_SAW2_SPM_STS2_ADDR A:0x64130038
y.create.l HWIO_QDSP6SS_SAW2_SPM_SLP_SEQ_ENTRY_0_ADDR A:0x64130400
y.create.l HWIO_QDSP6SS_SAW2_SPM_SLP_SEQ_ENTRY_1_ADDR A:0x64130404
y.create.l HWIO_QDSP6SS_SAW2_SPM_SLP_SEQ_ENTRY_2_ADDR A:0x64130408
y.create.l HWIO_QDSP6SS_SAW2_SPM_SLP_SEQ_ENTRY_3_ADDR A:0x6413040c
y.create.l HWIO_QDSP6SS_SAW2_SPM_SLP_SEQ_ENTRY_4_ADDR A:0x64130410
y.create.l HWIO_QDSP6SS_SAW2_SPM_SLP_SEQ_ENTRY_5_ADDR A:0x64130414
y.create.l HWIO_QDSP6SS_SAW2_SPM_SLP_SEQ_ENTRY_6_ADDR A:0x64130418
y.create.l HWIO_QDSP6SS_SAW2_SPM_SLP_SEQ_ENTRY_7_ADDR A:0x6413041c
y.create.l HWIO_QDSP6SS_SAW2_SPM_SLP_SEQ_ENTRY_8_ADDR A:0x64130420
y.create.l HWIO_QDSP6SS_SAW2_SPM_SLP_SEQ_ENTRY_9_ADDR A:0x64130424
y.create.l HWIO_QDSP6SS_SAW2_SPM_PMIC_DATA_0_ADDR A:0x64130040
y.create.l HWIO_QDSP6SS_SAW2_SPM_PMIC_DATA_1_ADDR A:0x64130044
y.create.l HWIO_QDSP6SS_SAW2_SPM_PMIC_DATA_2_ADDR A:0x64130048
y.create.l HWIO_QDSP6SS_SAW2_SPM_PMIC_DATA_3_ADDR A:0x6413004c
y.create.l HWIO_QDSP6SS_SAW2_VERSION_ADDR A:0x64130fd0
y.create.l HWIO_MSS_ENABLE_ADDR A:0x64180000
y.create.l HWIO_MSS_CLAMP_MEM_ADDR A:0x64180004
y.create.l HWIO_MSS_CLAMP_IO_ADDR A:0x64180008
y.create.l HWIO_MSS_BUS_AHB2AHB_CFG_ADDR A:0x6418000c
y.create.l HWIO_MSS_BUS_MAXI2AXI_CFG_ADDR A:0x64180010
y.create.l HWIO_MSS_CUSTOM_MEM_ARRSTBYN_ADDR A:0x64180014
y.create.l HWIO_MSS_ANALOG_IP_TEST_CTL_ADDR A:0x64180018
y.create.l HWIO_MSS_ATB_ID_ADDR A:0x6418001c
y.create.l HWIO_MSS_DBG_BUS_CTL_ADDR A:0x64180020
y.create.l HWIO_MSS_AHB_ACCESS_ERR_IRQ_EN_ADDR A:0x64180024
y.create.l HWIO_MSS_AHB_ACCESS_ERR_IRQ_STATUS_ADDR A:0x64180028
y.create.l HWIO_MSS_AHB_ACCESS_ERR_IRQ_CLR_ADDR A:0x6418002c
y.create.l HWIO_MSS_BUS_CTL_CFG_ADDR A:0x64180030
y.create.l HWIO_MSS_MSA_ADDR A:0x64180058
y.create.l HWIO_MSS_HW_VERSION_ADDR A:0x6418005c
y.create.l HWIO_MSS_MODEM_MEM_SLP_CNTL_ADDR A:0x64180060
y.create.l HWIO_MSS_CLOCK_SPDM_MON_ADDR A:0x64180064
y.create.l HWIO_MSS_BBRX0_MUX_SEL_ADDR A:0x64180068
y.create.l HWIO_MSS_BBRX1_MUX_SEL_ADDR A:0x6418006c
y.create.l HWIO_MSS_DEBUG_CLOCK_CTL_ADDR A:0x64180078
y.create.l HWIO_MSS_BBRX_EXT_CLOCK_MUX_SEL_ADDR A:0x6418007c
y.create.l HWIO_MSS_BBRX_CTL_ADDR A:0x64180094
y.create.l HWIO_MSS_DEBUG_CTL_ADDR A:0x64180098
y.create.l HWIO_MSS_POWER_ADDR A:0x6418009c
y.create.l HWIO_MSS_MSA_NC_HM_ADDR A:0x641800a0
y.create.l HWIO_MSS_CXM_ADDR A:0x641800a4
y.create.l HWIO_MSS_RELAY_MSG_SHADOW_00_ADDR A:0x64180400
y.create.l HWIO_MSS_RELAY_MSG_SHADOW_01_ADDR A:0x64180404
y.create.l HWIO_MSS_RELAY_MSG_SHADOW_02_ADDR A:0x64180408
y.create.l HWIO_MSS_RELAY_MSG_SHADOW_03_ADDR A:0x6418040c
y.create.l HWIO_MSS_RELAY_MSG_SHADOW_04_ADDR A:0x64180410
y.create.l HWIO_MSS_RELAY_MSG_SHADOW_05_ADDR A:0x64180414
y.create.l HWIO_MSS_RELAY_MSG_SHADOW_06_ADDR A:0x64180418
y.create.l HWIO_MSS_RELAY_MSG_SHADOW_07_ADDR A:0x6418041c
y.create.l HWIO_MSS_RELAY_MSG_SHADOW_08_ADDR A:0x64180420
y.create.l HWIO_MSS_RELAY_MSG_SHADOW_09_ADDR A:0x64180424
y.create.l HWIO_MSS_RELAY_MSG_SHADOW_10_ADDR A:0x64180428
y.create.l HWIO_MSS_RELAY_MSG_SHADOW_11_ADDR A:0x6418042c
y.create.l HWIO_MSS_RELAY_MSG_SHADOW_12_ADDR A:0x64180430
y.create.l HWIO_MSS_RELAY_MSG_SHADOW_13_ADDR A:0x64180434
y.create.l HWIO_MSS_RELAY_MSG_SHADOW_14_ADDR A:0x64180438
y.create.l HWIO_MSS_RELAY_MSG_SHADOW_15_ADDR A:0x6418043c
y.create.l HWIO_MSS_MPLL1_MODE_ADDR A:0x64181020
y.create.l HWIO_MSS_MPLL1_L_VAL_ADDR A:0x64181024
y.create.l HWIO_MSS_MPLL1_M_VAL_ADDR A:0x64181028
y.create.l HWIO_MSS_MPLL1_N_VAL_ADDR A:0x6418102c
y.create.l HWIO_MSS_MPLL1_USER_CTL_ADDR A:0x64181030
y.create.l HWIO_MSS_MPLL1_CONFIG_CTL_ADDR A:0x64181034
y.create.l HWIO_MSS_MPLL1_TEST_CTL_ADDR A:0x64181038
y.create.l HWIO_MSS_MPLL1_STATUS_ADDR A:0x6418103c
y.create.l HWIO_MSS_UIM0_BCR_ADDR A:0x64181060
y.create.l HWIO_MSS_UIM1_BCR_ADDR A:0x64181064
y.create.l HWIO_MSS_Q6SS_BCR_ADDR A:0x64181068
y.create.l HWIO_MSS_NAV_CE_BRIDGE_BCR_ADDR A:0x6418106c
y.create.l HWIO_MSS_CRYPTO_BCR_ADDR A:0x64181070
y.create.l HWIO_MSS_NAV_BCR_ADDR A:0x64181074
y.create.l HWIO_MSS_UIM0_CBCR_ADDR A:0x64181078
y.create.l HWIO_MSS_UIM1_CBCR_ADDR A:0x6418107c
y.create.l HWIO_MSS_XO_UIM0_CBCR_ADDR A:0x64181080
y.create.l HWIO_MSS_XO_UIM1_CBCR_ADDR A:0x64181084
y.create.l HWIO_MSS_XO_MODEM_CBCR_ADDR A:0x64181088
y.create.l HWIO_MSS_BUS_UIM0_CBCR_ADDR A:0x64181090
y.create.l HWIO_MSS_BUS_UIM1_CBCR_ADDR A:0x64181094
y.create.l HWIO_MSS_BUS_CSR_CBCR_ADDR A:0x64181098
y.create.l HWIO_MSS_BUS_BRIDGE_CBCR_ADDR A:0x6418109c
y.create.l HWIO_MSS_BUS_MODEM_CBCR_ADDR A:0x641810a0
y.create.l HWIO_MSS_BUS_Q6_CBCR_ADDR A:0x641810a4
y.create.l HWIO_MSS_BUS_NAV_CE_BRIDGE_CBCR_ADDR A:0x641810a8
y.create.l HWIO_MSS_BUS_CRYPTO_CBCR_ADDR A:0x641810ac
y.create.l HWIO_MSS_BUS_NAV_CBCR_ADDR A:0x641810b0
y.create.l HWIO_MSS_BUS_ATB_CBCR_ADDR A:0x641810b8
y.create.l HWIO_MSS_BUS_MODEM_BRIDGE_CX_CBCR_ADDR A:0x641810c0
y.create.l HWIO_MSS_BUS_SLAVE_TIMEOUT_CBCR_ADDR A:0x641810c4
y.create.l HWIO_MSS_BUS_COMBODAC_COMP_CBCR_ADDR A:0x641810cc
y.create.l HWIO_MSS_MODEM_CFG_AHB_CBCR_ADDR A:0x641810d4
y.create.l HWIO_MSS_MODEM_SNOC_AXI_CBCR_ADDR A:0x641810d8
y.create.l HWIO_MSS_NAV_SNOC_AXI_CBCR_ADDR A:0x641810dc
y.create.l HWIO_MSS_MPLL2_MAIN_BUS_CBCR_ADDR A:0x641810e0
y.create.l HWIO_MSS_MPLL1_MAIN_CBCR_ADDR A:0x641810e8
y.create.l HWIO_MSS_MPLL1_MAIN_BUS_CBCR_ADDR A:0x641810ec
y.create.l HWIO_MSS_MPLL1_EARLY_DIV5_CBCR_ADDR A:0x641810f0
y.create.l HWIO_MSS_MPLL1_EARLY_DIV3_CBCR_ADDR A:0x641810f4
y.create.l HWIO_MSS_MPLL1_OUT_EARLY_DIV3_CBCR_ADDR A:0x64181100
y.create.l HWIO_MSS_MPLL1_OUT_EARLY_DIV5_CBCR_ADDR A:0x64181104
y.create.l HWIO_MSS_BUS_CMD_RCGR_ADDR A:0x64181108
y.create.l HWIO_MSS_BUS_CFG_RCGR_ADDR A:0x6418110c
y.create.l HWIO_MSS_Q6_CMD_RCGR_ADDR A:0x64181110
y.create.l HWIO_MSS_Q6_CFG_RCGR_ADDR A:0x64181114
y.create.l HWIO_MSS_UIM_CMD_RCGR_ADDR A:0x64181118
y.create.l HWIO_MSS_UIM_CFG_RCGR_ADDR A:0x6418111c
y.create.l HWIO_MSS_BBRX0_CBCR_ADDR A:0x64181120
y.create.l HWIO_MSS_BBRX1_CBCR_ADDR A:0x64181124
y.create.l HWIO_MSS_BIMC_THROTTLE_ADDR A:0x64181130
y.create.l HWIO_MSS_RESERVE_02_ADDR A:0x64181134
y.create.l HWIO_MSS_BBRX0_MISC_ADDR A:0x64181138
y.create.l HWIO_MSS_BBRX1_MISC_ADDR A:0x6418113c
y.create.l HWIO_MSS_UIM0_MND_CMD_RCGR_ADDR A:0x64181150
y.create.l HWIO_MSS_UIM0_MND_CFG_RCGR_ADDR A:0x64181154
y.create.l HWIO_MSS_UIM0_MND_M_ADDR A:0x64181158
y.create.l HWIO_MSS_UIM0_MND_N_ADDR A:0x6418115c
y.create.l HWIO_MSS_UIM0_MND_D_ADDR A:0x64181160
y.create.l HWIO_MSS_UIM1_MND_CMD_RCGR_ADDR A:0x64181164
y.create.l HWIO_MSS_UIM1_MND_CFG_RCGR_ADDR A:0x64181168
y.create.l HWIO_MSS_UIM1_MND_M_ADDR A:0x6418116c
y.create.l HWIO_MSS_UIM1_MND_N_ADDR A:0x64181170
y.create.l HWIO_MSS_UIM1_MND_D_ADDR A:0x64181174
y.create.l HWIO_MSS_BUS_MGPI_CBCR_ADDR A:0x6418119c
y.create.l HWIO_MSS_MGPI_BCR_ADDR A:0x641811a0
y.create.l HWIO_MSS_BIT_COXM_MND_CMD_RCGR_ADDR A:0x64181214
y.create.l HWIO_MSS_BIT_COXM_MND_CFG_RCGR_ADDR A:0x64181218
y.create.l HWIO_MSS_BIT_COXM_MND_M_ADDR A:0x6418121c
y.create.l HWIO_MSS_BIT_COXM_MND_N_ADDR A:0x64181220
y.create.l HWIO_MSS_BIT_COXM_MND_D_ADDR A:0x64181224
y.create.l HWIO_MSS_BIT_COXM_CBCR_ADDR A:0x6418122c
y.create.l HWIO_MSS_BUS_COXM_CBCR_ADDR A:0x64181230
y.create.l HWIO_MSS_COXM_BCR_ADDR A:0x64181234
y.create.l HWIO_MSS_TCSR_ACC_SEL_ADDR A:0x6418f000
y.create.l HWIO_MSS_UIM0_UART_DM_MR1_ADDR A:0x64190000
y.create.l HWIO_MSS_UIM0_UART_DM_MR2_ADDR A:0x64190004
y.create.l HWIO_MSS_UIM0_UART_DM_CSR_SR_DEPRECATED_ADDR A:0x64190008
y.create.l HWIO_MSS_UIM0_UART_DM_CR_MISR_DEPRECATED_ADDR A:0x64190010
y.create.l HWIO_MSS_UIM0_UART_DM_IMR_ISR_DEPRECATED_ADDR A:0x64190014
y.create.l HWIO_MSS_UIM0_UART_DM_IPR_ADDR A:0x64190018
y.create.l HWIO_MSS_UIM0_UART_DM_TFWR_ADDR A:0x6419001c
y.create.l HWIO_MSS_UIM0_UART_DM_RFWR_ADDR A:0x64190020
y.create.l HWIO_MSS_UIM0_UART_DM_HCR_ADDR A:0x64190024
y.create.l HWIO_MSS_UIM0_UART_DM_DMRX_ADDR A:0x64190034
y.create.l HWIO_MSS_UIM0_UART_DM_IRDA_RX_TOTAL_SNAP_DEPRECATED_ADDR A:0x64190038
y.create.l HWIO_MSS_UIM0_UART_DM_DMEN_ADDR A:0x6419003c
y.create.l HWIO_MSS_UIM0_UART_DM_NO_CHARS_FOR_TX_ADDR A:0x64190040
y.create.l HWIO_MSS_UIM0_UART_DM_BADR_ADDR A:0x64190044
y.create.l HWIO_MSS_UIM0_UART_DM_TESTSL_ADDR A:0x64190048
y.create.l HWIO_MSS_UIM0_UART_DM_TXFS_ADDR A:0x6419004c
y.create.l HWIO_MSS_UIM0_UART_DM_RXFS_ADDR A:0x64190050
y.create.l HWIO_MSS_UIM0_UART_DM_MISR_MODE_ADDR A:0x64190060
y.create.l HWIO_MSS_UIM0_UART_DM_MISR_RESET_ADDR A:0x64190064
y.create.l HWIO_MSS_UIM0_UART_DM_MISR_EXPORT_ADDR A:0x64190068
y.create.l HWIO_MSS_UIM0_UART_DM_MISR_VAL_ADDR A:0x6419006c
y.create.l HWIO_MSS_UIM0_UART_DM_TF_RF_DEPRECATED_ADDR A:0x64190070
y.create.l HWIO_MSS_UIM0_UART_DM_TF_RF_2_DEPRECATED_ADDR A:0x64190074
y.create.l HWIO_MSS_UIM0_UART_DM_TF_RF_3_DEPRECATED_ADDR A:0x64190078
y.create.l HWIO_MSS_UIM0_UART_DM_TF_RF_4_DEPRECATED_ADDR A:0x6419007c
y.create.l HWIO_MSS_UIM0_UART_DM_SIM_CFG_ADDR A:0x64190080
y.create.l HWIO_MSS_UIM0_UART_DM_TEST_WR_ADDR_ADDR A:0x64190084
y.create.l HWIO_MSS_UIM0_UART_DM_TEST_WR_DATA_ADDR A:0x64190088
y.create.l HWIO_MSS_UIM0_UART_DM_TEST_RD_ADDR_ADDR A:0x6419008c
y.create.l HWIO_MSS_UIM0_UART_DM_TEST_RD_DATA_ADDR A:0x64190090
y.create.l HWIO_MSS_UIM0_UART_DM_CSR_ADDR A:0x641900a0
y.create.l HWIO_MSS_UIM0_UART_DM_SR_ADDR A:0x641900a4
y.create.l HWIO_MSS_UIM0_UART_DM_CR_ADDR A:0x641900a8
y.create.l HWIO_MSS_UIM0_UART_DM_MISR_ADDR A:0x641900ac
y.create.l HWIO_MSS_UIM0_UART_DM_IMR_ADDR A:0x641900b0
y.create.l HWIO_MSS_UIM0_UART_DM_ISR_ADDR A:0x641900b4
y.create.l HWIO_MSS_UIM0_UART_DM_IRDA_ADDR A:0x641900b8
y.create.l HWIO_MSS_UIM0_UART_DM_RX_TOTAL_SNAP_ADDR A:0x641900bc
y.create.l HWIO_MSS_UIM0_UART_DM_WWT_TIMEOUT_ADDR A:0x641900c0
y.create.l HWIO_MSS_UIM0_UART_DM_CLK_CTRL_ADDR A:0x641900c4
y.create.l HWIO_MSS_UIM0_UART_DM_BCR_ADDR A:0x641900c8
y.create.l HWIO_MSS_UIM0_UART_DM_RX_TRANS_CTRL_ADDR A:0x641900cc
y.create.l HWIO_MSS_UIM0_UART_DM_DMRX_DBG_ADDR A:0x641900d0
y.create.l HWIO_MSS_UIM0_UART_DM_FSM_STATUS_ADDR A:0x641900d4
y.create.l HWIO_MSS_UIM0_UART_DM_HW_VERSION_ADDR A:0x641900d8
y.create.l HWIO_MSS_UIM0_UART_DM_GENERICS_ADDR A:0x641900dc
y.create.l HWIO_MSS_UIM0_UART_DM_ISR_CLR_ADDR A:0x641900e0
y.create.l HWIO_MSS_UIM0_UART_DM_TF_ADDR A:0x64190100
y.create.l HWIO_MSS_UIM0_UART_DM_TF_2_ADDR A:0x64190104
y.create.l HWIO_MSS_UIM0_UART_DM_TF_3_ADDR A:0x64190108
y.create.l HWIO_MSS_UIM0_UART_DM_TF_4_ADDR A:0x6419010c
y.create.l HWIO_MSS_UIM0_UART_DM_TF_5_ADDR A:0x64190110
y.create.l HWIO_MSS_UIM0_UART_DM_TF_6_ADDR A:0x64190114
y.create.l HWIO_MSS_UIM0_UART_DM_TF_7_ADDR A:0x64190118
y.create.l HWIO_MSS_UIM0_UART_DM_TF_8_ADDR A:0x6419011c
y.create.l HWIO_MSS_UIM0_UART_DM_TF_9_ADDR A:0x64190120
y.create.l HWIO_MSS_UIM0_UART_DM_TF_10_ADDR A:0x64190124
y.create.l HWIO_MSS_UIM0_UART_DM_TF_11_ADDR A:0x64190128
y.create.l HWIO_MSS_UIM0_UART_DM_TF_12_ADDR A:0x6419012c
y.create.l HWIO_MSS_UIM0_UART_DM_TF_13_ADDR A:0x64190130
y.create.l HWIO_MSS_UIM0_UART_DM_TF_14_ADDR A:0x64190134
y.create.l HWIO_MSS_UIM0_UART_DM_TF_15_ADDR A:0x64190138
y.create.l HWIO_MSS_UIM0_UART_DM_TF_16_ADDR A:0x6419013c
y.create.l HWIO_MSS_UIM0_UART_DM_RF_ADDR A:0x64190140
y.create.l HWIO_MSS_UIM0_UART_DM_RF_2_ADDR A:0x64190144
y.create.l HWIO_MSS_UIM0_UART_DM_RF_3_ADDR A:0x64190148
y.create.l HWIO_MSS_UIM0_UART_DM_RF_4_ADDR A:0x6419014c
y.create.l HWIO_MSS_UIM0_UART_DM_RF_5_ADDR A:0x64190150
y.create.l HWIO_MSS_UIM0_UART_DM_RF_6_ADDR A:0x64190154
y.create.l HWIO_MSS_UIM0_UART_DM_RF_7_ADDR A:0x64190158
y.create.l HWIO_MSS_UIM0_UART_DM_RF_8_ADDR A:0x6419015c
y.create.l HWIO_MSS_UIM0_UART_DM_RF_9_ADDR A:0x64190160
y.create.l HWIO_MSS_UIM0_UART_DM_RF_10_ADDR A:0x64190164
y.create.l HWIO_MSS_UIM0_UART_DM_RF_11_ADDR A:0x64190168
y.create.l HWIO_MSS_UIM0_UART_DM_RF_12_ADDR A:0x6419016c
y.create.l HWIO_MSS_UIM0_UART_DM_RF_13_ADDR A:0x64190170
y.create.l HWIO_MSS_UIM0_UART_DM_RF_14_ADDR A:0x64190174
y.create.l HWIO_MSS_UIM0_UART_DM_RF_15_ADDR A:0x64190178
y.create.l HWIO_MSS_UIM0_UART_DM_RF_16_ADDR A:0x6419017c
y.create.l HWIO_MSS_UIM0_UART_DM_UIM_CFG_ADDR A:0x64190180
y.create.l HWIO_MSS_UIM0_UART_DM_UIM_CMD_ADDR A:0x64190184
y.create.l HWIO_MSS_UIM0_UART_DM_UIM_IO_STATUS_ADDR A:0x64190188
y.create.l HWIO_MSS_UIM0_UART_DM_UIM_IRQ_ISR_ADDR A:0x6419018c
y.create.l HWIO_MSS_UIM0_UART_DM_UIM_IRQ_MISR_ADDR A:0x64190190
y.create.l HWIO_MSS_UIM0_UART_DM_UIM_IRQ_CLR_ADDR A:0x64190194
y.create.l HWIO_MSS_UIM0_UART_DM_UIM_IRQ_IMR_ADDR A:0x64190198
y.create.l HWIO_MSS_UIM0_UART_DM_UIM_IRQ_IMR_SET_ADDR A:0x6419019c
y.create.l HWIO_MSS_UIM0_UART_DM_UIM_IRQ_IMR_CLR_ADDR A:0x641901a0
y.create.l HWIO_MSS_UIM1_UART_DM_MR1_ADDR A:0x64198000
y.create.l HWIO_MSS_UIM1_UART_DM_MR2_ADDR A:0x64198004
y.create.l HWIO_MSS_UIM1_UART_DM_CSR_SR_DEPRECATED_ADDR A:0x64198008
y.create.l HWIO_MSS_UIM1_UART_DM_CR_MISR_DEPRECATED_ADDR A:0x64198010
y.create.l HWIO_MSS_UIM1_UART_DM_IMR_ISR_DEPRECATED_ADDR A:0x64198014
y.create.l HWIO_MSS_UIM1_UART_DM_IPR_ADDR A:0x64198018
y.create.l HWIO_MSS_UIM1_UART_DM_TFWR_ADDR A:0x6419801c
y.create.l HWIO_MSS_UIM1_UART_DM_RFWR_ADDR A:0x64198020
y.create.l HWIO_MSS_UIM1_UART_DM_HCR_ADDR A:0x64198024
y.create.l HWIO_MSS_UIM1_UART_DM_DMRX_ADDR A:0x64198034
y.create.l HWIO_MSS_UIM1_UART_DM_IRDA_RX_TOTAL_SNAP_DEPRECATED_ADDR A:0x64198038
y.create.l HWIO_MSS_UIM1_UART_DM_DMEN_ADDR A:0x6419803c
y.create.l HWIO_MSS_UIM1_UART_DM_NO_CHARS_FOR_TX_ADDR A:0x64198040
y.create.l HWIO_MSS_UIM1_UART_DM_BADR_ADDR A:0x64198044
y.create.l HWIO_MSS_UIM1_UART_DM_TESTSL_ADDR A:0x64198048
y.create.l HWIO_MSS_UIM1_UART_DM_TXFS_ADDR A:0x6419804c
y.create.l HWIO_MSS_UIM1_UART_DM_RXFS_ADDR A:0x64198050
y.create.l HWIO_MSS_UIM1_UART_DM_MISR_MODE_ADDR A:0x64198060
y.create.l HWIO_MSS_UIM1_UART_DM_MISR_RESET_ADDR A:0x64198064
y.create.l HWIO_MSS_UIM1_UART_DM_MISR_EXPORT_ADDR A:0x64198068
y.create.l HWIO_MSS_UIM1_UART_DM_MISR_VAL_ADDR A:0x6419806c
y.create.l HWIO_MSS_UIM1_UART_DM_TF_RF_DEPRECATED_ADDR A:0x64198070
y.create.l HWIO_MSS_UIM1_UART_DM_TF_RF_2_DEPRECATED_ADDR A:0x64198074
y.create.l HWIO_MSS_UIM1_UART_DM_TF_RF_3_DEPRECATED_ADDR A:0x64198078
y.create.l HWIO_MSS_UIM1_UART_DM_TF_RF_4_DEPRECATED_ADDR A:0x6419807c
y.create.l HWIO_MSS_UIM1_UART_DM_SIM_CFG_ADDR A:0x64198080
y.create.l HWIO_MSS_UIM1_UART_DM_TEST_WR_ADDR_ADDR A:0x64198084
y.create.l HWIO_MSS_UIM1_UART_DM_TEST_WR_DATA_ADDR A:0x64198088
y.create.l HWIO_MSS_UIM1_UART_DM_TEST_RD_ADDR_ADDR A:0x6419808c
y.create.l HWIO_MSS_UIM1_UART_DM_TEST_RD_DATA_ADDR A:0x64198090
y.create.l HWIO_MSS_UIM1_UART_DM_CSR_ADDR A:0x641980a0
y.create.l HWIO_MSS_UIM1_UART_DM_SR_ADDR A:0x641980a4
y.create.l HWIO_MSS_UIM1_UART_DM_CR_ADDR A:0x641980a8
y.create.l HWIO_MSS_UIM1_UART_DM_MISR_ADDR A:0x641980ac
y.create.l HWIO_MSS_UIM1_UART_DM_IMR_ADDR A:0x641980b0
y.create.l HWIO_MSS_UIM1_UART_DM_ISR_ADDR A:0x641980b4
y.create.l HWIO_MSS_UIM1_UART_DM_IRDA_ADDR A:0x641980b8
y.create.l HWIO_MSS_UIM1_UART_DM_RX_TOTAL_SNAP_ADDR A:0x641980bc
y.create.l HWIO_MSS_UIM1_UART_DM_WWT_TIMEOUT_ADDR A:0x641980c0
y.create.l HWIO_MSS_UIM1_UART_DM_CLK_CTRL_ADDR A:0x641980c4
y.create.l HWIO_MSS_UIM1_UART_DM_BCR_ADDR A:0x641980c8
y.create.l HWIO_MSS_UIM1_UART_DM_RX_TRANS_CTRL_ADDR A:0x641980cc
y.create.l HWIO_MSS_UIM1_UART_DM_DMRX_DBG_ADDR A:0x641980d0
y.create.l HWIO_MSS_UIM1_UART_DM_FSM_STATUS_ADDR A:0x641980d4
y.create.l HWIO_MSS_UIM1_UART_DM_HW_VERSION_ADDR A:0x641980d8
y.create.l HWIO_MSS_UIM1_UART_DM_GENERICS_ADDR A:0x641980dc
y.create.l HWIO_MSS_UIM1_UART_DM_ISR_CLR_ADDR A:0x641980e0
y.create.l HWIO_MSS_UIM1_UART_DM_TF_ADDR A:0x64198100
y.create.l HWIO_MSS_UIM1_UART_DM_TF_2_ADDR A:0x64198104
y.create.l HWIO_MSS_UIM1_UART_DM_TF_3_ADDR A:0x64198108
y.create.l HWIO_MSS_UIM1_UART_DM_TF_4_ADDR A:0x6419810c
y.create.l HWIO_MSS_UIM1_UART_DM_TF_5_ADDR A:0x64198110
y.create.l HWIO_MSS_UIM1_UART_DM_TF_6_ADDR A:0x64198114
y.create.l HWIO_MSS_UIM1_UART_DM_TF_7_ADDR A:0x64198118
y.create.l HWIO_MSS_UIM1_UART_DM_TF_8_ADDR A:0x6419811c
y.create.l HWIO_MSS_UIM1_UART_DM_TF_9_ADDR A:0x64198120
y.create.l HWIO_MSS_UIM1_UART_DM_TF_10_ADDR A:0x64198124
y.create.l HWIO_MSS_UIM1_UART_DM_TF_11_ADDR A:0x64198128
y.create.l HWIO_MSS_UIM1_UART_DM_TF_12_ADDR A:0x6419812c
y.create.l HWIO_MSS_UIM1_UART_DM_TF_13_ADDR A:0x64198130
y.create.l HWIO_MSS_UIM1_UART_DM_TF_14_ADDR A:0x64198134
y.create.l HWIO_MSS_UIM1_UART_DM_TF_15_ADDR A:0x64198138
y.create.l HWIO_MSS_UIM1_UART_DM_TF_16_ADDR A:0x6419813c
y.create.l HWIO_MSS_UIM1_UART_DM_RF_ADDR A:0x64198140
y.create.l HWIO_MSS_UIM1_UART_DM_RF_2_ADDR A:0x64198144
y.create.l HWIO_MSS_UIM1_UART_DM_RF_3_ADDR A:0x64198148
y.create.l HWIO_MSS_UIM1_UART_DM_RF_4_ADDR A:0x6419814c
y.create.l HWIO_MSS_UIM1_UART_DM_RF_5_ADDR A:0x64198150
y.create.l HWIO_MSS_UIM1_UART_DM_RF_6_ADDR A:0x64198154
y.create.l HWIO_MSS_UIM1_UART_DM_RF_7_ADDR A:0x64198158
y.create.l HWIO_MSS_UIM1_UART_DM_RF_8_ADDR A:0x6419815c
y.create.l HWIO_MSS_UIM1_UART_DM_RF_9_ADDR A:0x64198160
y.create.l HWIO_MSS_UIM1_UART_DM_RF_10_ADDR A:0x64198164
y.create.l HWIO_MSS_UIM1_UART_DM_RF_11_ADDR A:0x64198168
y.create.l HWIO_MSS_UIM1_UART_DM_RF_12_ADDR A:0x6419816c
y.create.l HWIO_MSS_UIM1_UART_DM_RF_13_ADDR A:0x64198170
y.create.l HWIO_MSS_UIM1_UART_DM_RF_14_ADDR A:0x64198174
y.create.l HWIO_MSS_UIM1_UART_DM_RF_15_ADDR A:0x64198178
y.create.l HWIO_MSS_UIM1_UART_DM_RF_16_ADDR A:0x6419817c
y.create.l HWIO_MSS_UIM1_UART_DM_UIM_CFG_ADDR A:0x64198180
y.create.l HWIO_MSS_UIM1_UART_DM_UIM_CMD_ADDR A:0x64198184
y.create.l HWIO_MSS_UIM1_UART_DM_UIM_IO_STATUS_ADDR A:0x64198188
y.create.l HWIO_MSS_UIM1_UART_DM_UIM_IRQ_ISR_ADDR A:0x6419818c
y.create.l HWIO_MSS_UIM1_UART_DM_UIM_IRQ_MISR_ADDR A:0x64198190
y.create.l HWIO_MSS_UIM1_UART_DM_UIM_IRQ_CLR_ADDR A:0x64198194
y.create.l HWIO_MSS_UIM1_UART_DM_UIM_IRQ_IMR_ADDR A:0x64198198
y.create.l HWIO_MSS_UIM1_UART_DM_UIM_IRQ_IMR_SET_ADDR A:0x6419819c
y.create.l HWIO_MSS_UIM1_UART_DM_UIM_IRQ_IMR_CLR_ADDR A:0x641981a0
y.create.l HWIO_MSS_CXM_UART_DM_MR1_ADDR A:0x641a0000
y.create.l HWIO_MSS_CXM_UART_DM_MR2_ADDR A:0x641a0004
y.create.l HWIO_MSS_CXM_UART_DM_CSR_SR_DEPRECATED_ADDR A:0x641a0008
y.create.l HWIO_MSS_CXM_UART_DM_CR_MISR_DEPRECATED_ADDR A:0x641a0010
y.create.l HWIO_MSS_CXM_UART_DM_IMR_ISR_DEPRECATED_ADDR A:0x641a0014
y.create.l HWIO_MSS_CXM_UART_DM_IPR_ADDR A:0x641a0018
y.create.l HWIO_MSS_CXM_UART_DM_TFWR_ADDR A:0x641a001c
y.create.l HWIO_MSS_CXM_UART_DM_RFWR_ADDR A:0x641a0020
y.create.l HWIO_MSS_CXM_UART_DM_HCR_ADDR A:0x641a0024
y.create.l HWIO_MSS_CXM_UART_DM_DMRX_ADDR A:0x641a0034
y.create.l HWIO_MSS_CXM_UART_DM_IRDA_RX_TOTAL_SNAP_DEPRECATED_ADDR A:0x641a0038
y.create.l HWIO_MSS_CXM_UART_DM_DMEN_ADDR A:0x641a003c
y.create.l HWIO_MSS_CXM_UART_DM_NO_CHARS_FOR_TX_ADDR A:0x641a0040
y.create.l HWIO_MSS_CXM_UART_DM_BADR_ADDR A:0x641a0044
y.create.l HWIO_MSS_CXM_UART_DM_TESTSL_ADDR A:0x641a0048
y.create.l HWIO_MSS_CXM_UART_DM_TXFS_ADDR A:0x641a004c
y.create.l HWIO_MSS_CXM_UART_DM_RXFS_ADDR A:0x641a0050
y.create.l HWIO_MSS_CXM_UART_DM_MISR_MODE_ADDR A:0x641a0060
y.create.l HWIO_MSS_CXM_UART_DM_MISR_RESET_ADDR A:0x641a0064
y.create.l HWIO_MSS_CXM_UART_DM_MISR_EXPORT_ADDR A:0x641a0068
y.create.l HWIO_MSS_CXM_UART_DM_MISR_VAL_ADDR A:0x641a006c
y.create.l HWIO_MSS_CXM_UART_DM_TF_RF_DEPRECATED_ADDR A:0x641a0070
y.create.l HWIO_MSS_CXM_UART_DM_TF_RF_2_DEPRECATED_ADDR A:0x641a0074
y.create.l HWIO_MSS_CXM_UART_DM_TF_RF_3_DEPRECATED_ADDR A:0x641a0078
y.create.l HWIO_MSS_CXM_UART_DM_TF_RF_4_DEPRECATED_ADDR A:0x641a007c
y.create.l HWIO_MSS_CXM_UART_DM_SIM_CFG_ADDR A:0x641a0080
y.create.l HWIO_MSS_CXM_UART_DM_TEST_WR_ADDR_ADDR A:0x641a0084
y.create.l HWIO_MSS_CXM_UART_DM_TEST_WR_DATA_ADDR A:0x641a0088
y.create.l HWIO_MSS_CXM_UART_DM_TEST_RD_ADDR_ADDR A:0x641a008c
y.create.l HWIO_MSS_CXM_UART_DM_TEST_RD_DATA_ADDR A:0x641a0090
y.create.l HWIO_MSS_CXM_UART_DM_CSR_ADDR A:0x641a00a0
y.create.l HWIO_MSS_CXM_UART_DM_SR_ADDR A:0x641a00a4
y.create.l HWIO_MSS_CXM_UART_DM_CR_ADDR A:0x641a00a8
y.create.l HWIO_MSS_CXM_UART_DM_MISR_ADDR A:0x641a00ac
y.create.l HWIO_MSS_CXM_UART_DM_IMR_ADDR A:0x641a00b0
y.create.l HWIO_MSS_CXM_UART_DM_ISR_ADDR A:0x641a00b4
y.create.l HWIO_MSS_CXM_UART_DM_IRDA_ADDR A:0x641a00b8
y.create.l HWIO_MSS_CXM_UART_DM_RX_TOTAL_SNAP_ADDR A:0x641a00bc
y.create.l HWIO_MSS_CXM_UART_DM_WWT_TIMEOUT_ADDR A:0x641a00c0
y.create.l HWIO_MSS_CXM_UART_DM_CLK_CTRL_ADDR A:0x641a00c4
y.create.l HWIO_MSS_CXM_UART_DM_BCR_ADDR A:0x641a00c8
y.create.l HWIO_MSS_CXM_UART_DM_RX_TRANS_CTRL_ADDR A:0x641a00cc
y.create.l HWIO_MSS_CXM_UART_DM_DMRX_DBG_ADDR A:0x641a00d0
y.create.l HWIO_MSS_CXM_UART_DM_FSM_STATUS_ADDR A:0x641a00d4
y.create.l HWIO_MSS_CXM_UART_DM_HW_VERSION_ADDR A:0x641a00d8
y.create.l HWIO_MSS_CXM_UART_DM_GENERICS_ADDR A:0x641a00dc
y.create.l HWIO_MSS_CXM_UART_DM_TF_ADDR A:0x641a0100
y.create.l HWIO_MSS_CXM_UART_DM_TF_2_ADDR A:0x641a0104
y.create.l HWIO_MSS_CXM_UART_DM_TF_3_ADDR A:0x641a0108
y.create.l HWIO_MSS_CXM_UART_DM_TF_4_ADDR A:0x641a010c
y.create.l HWIO_MSS_CXM_UART_DM_TF_5_ADDR A:0x641a0110
y.create.l HWIO_MSS_CXM_UART_DM_TF_6_ADDR A:0x641a0114
y.create.l HWIO_MSS_CXM_UART_DM_TF_7_ADDR A:0x641a0118
y.create.l HWIO_MSS_CXM_UART_DM_TF_8_ADDR A:0x641a011c
y.create.l HWIO_MSS_CXM_UART_DM_TF_9_ADDR A:0x641a0120
y.create.l HWIO_MSS_CXM_UART_DM_TF_10_ADDR A:0x641a0124
y.create.l HWIO_MSS_CXM_UART_DM_TF_11_ADDR A:0x641a0128
y.create.l HWIO_MSS_CXM_UART_DM_TF_12_ADDR A:0x641a012c
y.create.l HWIO_MSS_CXM_UART_DM_TF_13_ADDR A:0x641a0130
y.create.l HWIO_MSS_CXM_UART_DM_TF_14_ADDR A:0x641a0134
y.create.l HWIO_MSS_CXM_UART_DM_TF_15_ADDR A:0x641a0138
y.create.l HWIO_MSS_CXM_UART_DM_TF_16_ADDR A:0x641a013c
y.create.l HWIO_MSS_CXM_UART_DM_RF_ADDR A:0x641a0140
y.create.l HWIO_MSS_CXM_UART_DM_RF_2_ADDR A:0x641a0144
y.create.l HWIO_MSS_CXM_UART_DM_RF_3_ADDR A:0x641a0148
y.create.l HWIO_MSS_CXM_UART_DM_RF_4_ADDR A:0x641a014c
y.create.l HWIO_MSS_CXM_UART_DM_RF_5_ADDR A:0x641a0150
y.create.l HWIO_MSS_CXM_UART_DM_RF_6_ADDR A:0x641a0154
y.create.l HWIO_MSS_CXM_UART_DM_RF_7_ADDR A:0x641a0158
y.create.l HWIO_MSS_CXM_UART_DM_RF_8_ADDR A:0x641a015c
y.create.l HWIO_MSS_CXM_UART_DM_RF_9_ADDR A:0x641a0160
y.create.l HWIO_MSS_CXM_UART_DM_RF_10_ADDR A:0x641a0164
y.create.l HWIO_MSS_CXM_UART_DM_RF_11_ADDR A:0x641a0168
y.create.l HWIO_MSS_CXM_UART_DM_RF_12_ADDR A:0x641a016c
y.create.l HWIO_MSS_CXM_UART_DM_RF_13_ADDR A:0x641a0170
y.create.l HWIO_MSS_CXM_UART_DM_RF_14_ADDR A:0x641a0174
y.create.l HWIO_MSS_CXM_UART_DM_RF_15_ADDR A:0x641a0178
y.create.l HWIO_MSS_CXM_UART_DM_RF_16_ADDR A:0x641a017c
y.create.l HWIO_MSS_CXM_UART_DM_UIM_CFG_ADDR A:0x641a0180
y.create.l HWIO_MSS_CXM_UART_DM_UIM_CMD_ADDR A:0x641a0184
y.create.l HWIO_MSS_CXM_UART_DM_UIM_IO_STATUS_ADDR A:0x641a0188
y.create.l HWIO_MSS_CXM_UART_DM_UIM_IRQ_ISR_ADDR A:0x641a018c
y.create.l HWIO_MSS_CXM_UART_DM_UIM_IRQ_MISR_ADDR A:0x641a0190
y.create.l HWIO_MSS_CXM_UART_DM_UIM_IRQ_CLR_ADDR A:0x641a0194
y.create.l HWIO_MSS_CXM_UART_DM_UIM_IRQ_IMR_ADDR A:0x641a0198
y.create.l HWIO_MSS_CXM_UART_DM_UIM_IRQ_IMR_SET_ADDR A:0x641a019c
y.create.l HWIO_MSS_CXM_UART_DM_UIM_IRQ_IMR_CLR_ADDR A:0x641a01a0
y.create.l HWIO_MSS_CXM_CONFIG_ADDR A:0x641a01a4
y.create.l HWIO_MSS_CXM_TX_CONFIG_ADDR A:0x641a01a8
y.create.l HWIO_MSS_CXM_RX_STAT_ADDR A:0x641a01ac
y.create.l HWIO_MSS_CXM_DBG_STAT_ADDR A:0x641a01b0
y.create.l HWIO_MSS_CXM_DIR_UART_TR_ADDR A:0x641a01b4
y.create.l HWIO_MSS_CXM_TYP0_RESP_TOUT_DUR_ADDR A:0x641a01b8
y.create.l HWIO_MSS_CXM_TYP0_RESP_STAT_ADDR A:0x641a01bc
y.create.l HWIO_MSS_CXM_WCN_PRIORITY_REG_STAT_ADDR A:0x641a01c0
y.create.l HWIO_MSS_CXM_RX_WCI2_MSG_TYPE0_CONTENT_ADDR A:0x641a01c4
y.create.l HWIO_MSS_CXM_RX_WCI2_MSG_TYPE1_CONTENT_ADDR A:0x641a01c8
y.create.l HWIO_MSS_CXM_RX_WCI2_MSG_TYPE2_CONTENT_ADDR A:0x641a01cc
y.create.l HWIO_MSS_CXM_RX_WCI2_MSG_TYPE3_CONTENT_ADDR A:0x641a01d0
y.create.l HWIO_MSS_CXM_RX_WCI2_MSG_TYPE4_CONTENT_ADDR A:0x641a01d4
y.create.l HWIO_MSS_CXM_RX_WCI2_MSG_TYPE5_CONTENT_ADDR A:0x641a01d8
y.create.l HWIO_MSS_CXM_RX_WCI2_MSG_TYPE6_CONTENT_ADDR A:0x641a01dc
y.create.l HWIO_MSS_CXM_RX_WCI2_MSG_TYPE7_CONTENT_ADDR A:0x641a01e0
y.create.l HWIO_MSS_CXM_SPARE_BITS_ADDR A:0x641a01e4
y.create.l HWIO_MSS_CONF_ABT_HW_VERSION_ADDR A:0x641b0000
y.create.l HWIO_MSS_CONF_ABT_INST_ID_ADDR A:0x641b0004
y.create.l HWIO_MSS_CONF_ABT_NUM_SLAVES_ADDR A:0x641b0008
y.create.l HWIO_MSS_CONF_ABT_TIMER_LOADVAL_ADDR A:0x641b000c
y.create.l HWIO_MSS_CONF_ABT_TIMER_MODE_ADDR A:0x641b0010
y.create.l HWIO_MSS_CONF_ABT_INTR_STATUS_ADDR A:0x641b0014
y.create.l HWIO_MSS_CONF_ABT_INTR_CLEAR_ADDR A:0x641b0018
y.create.l HWIO_MSS_CONF_ABT_INTR_ENABLE_ADDR A:0x641b001c
y.create.l HWIO_MSS_CONF_ABT_SYND_VALID_ADDR A:0x641b0020
y.create.l HWIO_MSS_CONF_ABT_SYND_CLEAR_ADDR A:0x641b0024
y.create.l HWIO_MSS_CONF_ABT_SYND_ID_ADDR A:0x641b0028
y.create.l HWIO_MSS_CONF_ABT_SYND_ADDR0_ADDR A:0x641b002c
y.create.l HWIO_MSS_CONF_ABT_SYND_ADDR1_ADDR A:0x641b0030
y.create.l HWIO_MSS_CONF_ABT_SYND_HREADY_ADDR A:0x641b0034
y.create.l HWIO_COMBODAC_CFG0_0_ADDR A:0x641b2000
y.create.l HWIO_COMBODAC_CFG1_0_ADDR A:0x641b2008
y.create.l HWIO_COMBODAC_CFG2_0_ADDR A:0x641b2010
y.create.l HWIO_COMBODAC_DIGVAL_EN_0_ADDR A:0x641b2020
y.create.l HWIO_COMBODAC_IREF_CTRL_0_ADDR A:0x641b2028
y.create.l HWIO_COMBODAC_CAL_CTRL_0_ADDR A:0x641b2030
y.create.l HWIO_COMBODAC_CAL_STATUS_0_ADDR A:0x641b2038
y.create.l HWIO_COMBODAC_MEM_RW_CTRL_0_ADDR A:0x641b2040
y.create.l HWIO_COMBODAC_MEM_RD_DATA_0_ADDR A:0x641b2048
y.create.l HWIO_COMBODAC_RTUNE_RW_CTRL_0_ADDR A:0x641b2050
y.create.l HWIO_COMBODAC_RTUNE_RD_DATA_0_ADDR A:0x641b2058
y.create.l HWIO_COMBODAC_DEBUG_INR_0_ADDR A:0x641b2060
y.create.l HWIO_COMBODAC_DEBUG_OUTR_0_ADDR A:0x641b2068
y.create.l HWIO_COMBODAC_DEBUG_ING_0_ADDR A:0x641b2070
y.create.l HWIO_COMBODAC_DEBUG_OUTG_0_ADDR A:0x641b2078
y.create.l HWIO_COMBODAC_TEST_CTRL_0_ADDR A:0x641b2080
y.create.l HWIO_COMBODAC_COMP_CMDS_ADDR A:0x641b2090
y.create.l HWIO_COMBODAC_COMP_STATUS_ADDR A:0x641b2094
y.create.l HWIO_COMBODAC_BIST_CFG_ADDR A:0x641b2098
y.create.l HWIO_COMBODAC_COMP_CTRL_ADDR A:0x641b209c
y.create.l HWIO_COMBODAC0_CLK_CFG_ADDR A:0x641b20a0
y.create.l HWIO_COMBODAC1_CLK_CFG_ADDR A:0x641b20a4
y.create.l HWIO_COMBODAC_CLK_SRC_CFG_ADDR A:0x641b20a8
y.create.l HWIO_COMBODAC_TIME_CYCLE_ADDR A:0x641b20ac
y.create.l HWIO_COMBODAC_FSM_STATE_MONIT_ADDR A:0x641b20b0
y.create.l HWIO_COMBODAC_IREF_STATUS_ADDR A:0x641b20b4
y.create.l HWIO_COMBODAC_REGARRAY0_ADDR A:0x641b2800
y.create.l HWIO_COMBODAC_REGARRAY1_ADDR A:0x641b2804
y.create.l HWIO_COMBODAC_REGARRAY2_ADDR A:0x641b2808
y.create.l HWIO_COMBODAC_REGARRAY3_ADDR A:0x641b280c
y.create.l HWIO_COMBODAC_REGARRAY4_ADDR A:0x641b2810
y.create.l HWIO_COMBODAC_REGARRAY5_ADDR A:0x641b2814
y.create.l HWIO_COMBODAC_REGARRAY6_ADDR A:0x641b2818
y.create.l HWIO_COMBODAC_REGARRAY7_ADDR A:0x641b281c
y.create.l HWIO_COMBODAC_REGARRAY8_ADDR A:0x641b2820
y.create.l HWIO_COMBODAC_REGARRAY9_ADDR A:0x641b2824
y.create.l HWIO_MSS_MGPI_PMIC_CONFIG0_ADDR A:0x641b3000
y.create.l HWIO_MSS_MGPI_PMIC_CONFIG1_ADDR A:0x641b3008
y.create.l HWIO_MSS_MGPI_PMIC_CONFIG2_ADDR A:0x641b3010
y.create.l HWIO_MSS_MGPI_PMIC_CONFIG3_ADDR A:0x641b3018
y.create.l HWIO_MSS_MGPI_PMIC_CONFIG4_ADDR A:0x641b3020
y.create.l HWIO_MSS_MGPI_PMIC_CONFIG5_ADDR A:0x641b3028
y.create.l HWIO_MSS_MGPI_PMIC_CONFIG6_ADDR A:0x641b3030
y.create.l HWIO_MSS_MGPI_PMIC_CONFIG7_ADDR A:0x641b3038
y.create.l HWIO_MSS_MGPI_PMIC_CONFIG8_ADDR A:0x641b3040
y.create.l HWIO_MSS_MGPI_PMIC_CONFIG9_ADDR A:0x641b3048
y.create.l HWIO_MSS_MGPI_CONF_STATUS0_ADDR A:0x641b3004
y.create.l HWIO_MSS_MGPI_CONF_STATUS1_ADDR A:0x641b300c
y.create.l HWIO_MSS_MGPI_CONF_STATUS2_ADDR A:0x641b3014
y.create.l HWIO_MSS_MGPI_CONF_STATUS3_ADDR A:0x641b301c
y.create.l HWIO_MSS_MGPI_CONF_STATUS4_ADDR A:0x641b3024
y.create.l HWIO_MSS_MGPI_CONF_STATUS5_ADDR A:0x641b302c
y.create.l HWIO_MSS_MGPI_CONF_STATUS6_ADDR A:0x641b3034
y.create.l HWIO_MSS_MGPI_CONF_STATUS7_ADDR A:0x641b303c
y.create.l HWIO_MSS_MGPI_CONF_STATUS8_ADDR A:0x641b3044
y.create.l HWIO_MSS_MGPI_CONF_STATUS9_ADDR A:0x641b304c
y.create.l HWIO_MSS_MGPI_MASTER_CSR_ADDR A:0x641b3100
y.create.l HWIO_MSS_MGPI_HW_VERSION_ADDR A:0x641b3104
y.create.l HWIO_MSS_CRYPTO_VERSION_ADDR A:0x641fa000
y.create.l HWIO_MSS_CRYPTO_DATA_IN0_ADDR A:0x641fa010
y.create.l HWIO_MSS_CRYPTO_DATA_IN1_ADDR A:0x641fa014
y.create.l HWIO_MSS_CRYPTO_DATA_IN2_ADDR A:0x641fa018
y.create.l HWIO_MSS_CRYPTO_DATA_IN3_ADDR A:0x641fa01c
y.create.l HWIO_MSS_CRYPTO_DATA_OUT0_ADDR A:0x641fa020
y.create.l HWIO_MSS_CRYPTO_DATA_OUT1_ADDR A:0x641fa024
y.create.l HWIO_MSS_CRYPTO_DATA_OUT2_ADDR A:0x641fa028
y.create.l HWIO_MSS_CRYPTO_DATA_OUT3_ADDR A:0x641fa02c
y.create.l HWIO_MSS_CRYPTO_STATUS_ADDR A:0x641fa100
y.create.l HWIO_MSS_CRYPTO_STATUS2_ADDR A:0x641fa104
y.create.l HWIO_MSS_CRYPTO_BIST_STATUS_ADDR A:0x641fa114
y.create.l HWIO_MSS_CRYPTO_BIST_FINISH_ADDR A:0x641fa118
y.create.l HWIO_MSS_CRYPTO_ENGINES_AVAIL_ADDR A:0x641fa108
y.create.l HWIO_MSS_CRYPTO_FIFO_SIZES_ADDR A:0x641fa10c
y.create.l HWIO_MSS_CRYPTO_SEG_SIZE_ADDR A:0x641fa110
y.create.l HWIO_MSS_CRYPTO_GOPROC_ADDR A:0x641fa120
y.create.l HWIO_MSS_CRYPTO_GOPROC_QC_KEY_ADDR A:0x641fb000
y.create.l HWIO_MSS_CRYPTO_GOPROC_OEM_KEY_ADDR A:0x641fc000
y.create.l HWIO_MSS_CRYPTO_ENCR_SEG_CFG_ADDR A:0x641fa200
y.create.l HWIO_MSS_CRYPTO_ENCR_SEG_SIZE_ADDR A:0x641fa204
y.create.l HWIO_MSS_CRYPTO_ENCR_SEG_START_ADDR A:0x641fa208
y.create.l HWIO_MSS_CRYPTO_ENCR_KEY0_ADDR A:0x641fd000
y.create.l HWIO_MSS_CRYPTO_ENCR_KEY1_ADDR A:0x641fd004
y.create.l HWIO_MSS_CRYPTO_ENCR_KEY2_ADDR A:0x641fd008
y.create.l HWIO_MSS_CRYPTO_ENCR_KEY3_ADDR A:0x641fd00c
y.create.l HWIO_MSS_CRYPTO_ENCR_KEY4_ADDR A:0x641fd010
y.create.l HWIO_MSS_CRYPTO_ENCR_KEY5_ADDR A:0x641fd014
y.create.l HWIO_MSS_CRYPTO_ENCR_KEY6_ADDR A:0x641fd018
y.create.l HWIO_MSS_CRYPTO_ENCR_KEY7_ADDR A:0x641fd01c
y.create.l HWIO_MSS_CRYPTO_ENCR_XTS_KEY0_ADDR A:0x641fd020
y.create.l HWIO_MSS_CRYPTO_ENCR_XTS_KEY1_ADDR A:0x641fd024
y.create.l HWIO_MSS_CRYPTO_ENCR_XTS_KEY2_ADDR A:0x641fd028
y.create.l HWIO_MSS_CRYPTO_ENCR_XTS_KEY3_ADDR A:0x641fd02c
y.create.l HWIO_MSS_CRYPTO_ENCR_XTS_KEY4_ADDR A:0x641fd030
y.create.l HWIO_MSS_CRYPTO_ENCR_XTS_KEY5_ADDR A:0x641fd034
y.create.l HWIO_MSS_CRYPTO_ENCR_XTS_KEY6_ADDR A:0x641fd038
y.create.l HWIO_MSS_CRYPTO_ENCR_XTS_KEY7_ADDR A:0x641fd03c
y.create.l HWIO_MSS_CRYPTO_ENCR_CNTR0_IV0_ADDR A:0x641fa20c
y.create.l HWIO_MSS_CRYPTO_ENCR_CNTR1_IV1_ADDR A:0x641fa210
y.create.l HWIO_MSS_CRYPTO_ENCR_CNTR2_IV2_ADDR A:0x641fa214
y.create.l HWIO_MSS_CRYPTO_ENCR_CNTR3_IV3_ADDR A:0x641fa218
y.create.l HWIO_MSS_CRYPTO_ENCR_CNTR_MASK_ADDR A:0x641fa21c
y.create.l HWIO_MSS_CRYPTO_ENCR_CNTR_MASK2_ADDR A:0x641fa234
y.create.l HWIO_MSS_CRYPTO_ENCR_CNTR_MASK1_ADDR A:0x641fa238
y.create.l HWIO_MSS_CRYPTO_ENCR_CNTR_MASK0_ADDR A:0x641fa23c
y.create.l HWIO_MSS_CRYPTO_ENCR_CCM_INIT_CNTR0_ADDR A:0x641fa220
y.create.l HWIO_MSS_CRYPTO_ENCR_CCM_INIT_CNTR1_ADDR A:0x641fa224
y.create.l HWIO_MSS_CRYPTO_ENCR_CCM_INIT_CNTR2_ADDR A:0x641fa228
y.create.l HWIO_MSS_CRYPTO_ENCR_CCM_INIT_CNTR3_ADDR A:0x641fa22c
y.create.l HWIO_MSS_CRYPTO_ENCR_XTS_DU_SIZE_ADDR A:0x641fa230
y.create.l HWIO_MSS_CRYPTO_AUTH_SEG_CFG_ADDR A:0x641fa300
y.create.l HWIO_MSS_CRYPTO_AUTH_SEG_SIZE_ADDR A:0x641fa304
y.create.l HWIO_MSS_CRYPTO_AUTH_SEG_START_ADDR A:0x641fa308
y.create.l HWIO_MSS_CRYPTO_AUTH_KEY0_ADDR A:0x641fd040
y.create.l HWIO_MSS_CRYPTO_AUTH_KEY1_ADDR A:0x641fd044
y.create.l HWIO_MSS_CRYPTO_AUTH_KEY2_ADDR A:0x641fd048
y.create.l HWIO_MSS_CRYPTO_AUTH_KEY3_ADDR A:0x641fd04c
y.create.l HWIO_MSS_CRYPTO_AUTH_KEY4_ADDR A:0x641fd050
y.create.l HWIO_MSS_CRYPTO_AUTH_KEY5_ADDR A:0x641fd054
y.create.l HWIO_MSS_CRYPTO_AUTH_KEY6_ADDR A:0x641fd058
y.create.l HWIO_MSS_CRYPTO_AUTH_KEY7_ADDR A:0x641fd05c
y.create.l HWIO_MSS_CRYPTO_AUTH_KEY8_ADDR A:0x641fd060
y.create.l HWIO_MSS_CRYPTO_AUTH_KEY9_ADDR A:0x641fd064
y.create.l HWIO_MSS_CRYPTO_AUTH_IV0_ADDR A:0x641fa310
y.create.l HWIO_MSS_CRYPTO_AUTH_IV1_ADDR A:0x641fa314
y.create.l HWIO_MSS_CRYPTO_AUTH_IV2_ADDR A:0x641fa318
y.create.l HWIO_MSS_CRYPTO_AUTH_IV3_ADDR A:0x641fa31c
y.create.l HWIO_MSS_CRYPTO_AUTH_IV4_ADDR A:0x641fa320
y.create.l HWIO_MSS_CRYPTO_AUTH_IV5_ADDR A:0x641fa324
y.create.l HWIO_MSS_CRYPTO_AUTH_IV6_ADDR A:0x641fa328
y.create.l HWIO_MSS_CRYPTO_AUTH_IV7_ADDR A:0x641fa32c
y.create.l HWIO_MSS_CRYPTO_AUTH_INFO_NONCE0_ADDR A:0x641fa350
y.create.l HWIO_MSS_CRYPTO_AUTH_INFO_NONCE1_ADDR A:0x641fa354
y.create.l HWIO_MSS_CRYPTO_AUTH_INFO_NONCE2_ADDR A:0x641fa358
y.create.l HWIO_MSS_CRYPTO_AUTH_INFO_NONCE3_ADDR A:0x641fa35c
y.create.l HWIO_MSS_CRYPTO_AUTH_BYTECNT0_ADDR A:0x641fa390
y.create.l HWIO_MSS_CRYPTO_AUTH_BYTECNT1_ADDR A:0x641fa394
y.create.l HWIO_MSS_CRYPTO_AUTH_EXP_MAC0_ADDR A:0x641fa3a0
y.create.l HWIO_MSS_CRYPTO_AUTH_EXP_MAC1_ADDR A:0x641fa3a4
y.create.l HWIO_MSS_CRYPTO_AUTH_EXP_MAC2_ADDR A:0x641fa3a8
y.create.l HWIO_MSS_CRYPTO_AUTH_EXP_MAC3_ADDR A:0x641fa3ac
y.create.l HWIO_MSS_CRYPTO_AUTH_EXP_MAC4_ADDR A:0x641fa3b0
y.create.l HWIO_MSS_CRYPTO_AUTH_EXP_MAC5_ADDR A:0x641fa3b4
y.create.l HWIO_MSS_CRYPTO_AUTH_EXP_MAC6_ADDR A:0x641fa3b8
y.create.l HWIO_MSS_CRYPTO_AUTH_EXP_MAC7_ADDR A:0x641fa3bc
y.create.l HWIO_MSS_CRYPTO_CONFIG_ADDR A:0x641fa400
y.create.l HWIO_MSS_CRYPTO_DEBUG_ENABLE_ADDR A:0x641ff000
y.create.l HWIO_MSS_CRYPTO_DEBUG_ADDR A:0x641ff004
y.create.l HWIO_MSS_CRYPTO_PWR_CTRL_ADDR A:0x641ff008
y.create.l HWIO_MSS_CRYPTO_BAM_CTRL_ADDR A:0x641c4000
y.create.l HWIO_MSS_CRYPTO_BAM_TIMER_ADDR A:0x641c4040
y.create.l HWIO_MSS_CRYPTO_BAM_TIMER_CTRL_ADDR A:0x641c4044
y.create.l HWIO_MSS_CRYPTO_BAM_DESC_CNT_TRSHLD_ADDR A:0x641c4008
y.create.l HWIO_MSS_CRYPTO_BAM_IRQ_STTS_ADDR A:0x641c4014
y.create.l HWIO_MSS_CRYPTO_BAM_IRQ_CLR_ADDR A:0x641c4018
y.create.l HWIO_MSS_CRYPTO_BAM_IRQ_EN_ADDR A:0x641c401c
y.create.l HWIO_MSS_CRYPTO_BAM_CNFG_BITS_ADDR A:0x641c407c
y.create.l HWIO_MSS_CRYPTO_BAM_CNFG_BITS_2_ADDR A:0x641c4084
y.create.l HWIO_MSS_CRYPTO_BAM_REVISION_ADDR A:0x641c5000
y.create.l HWIO_MSS_CRYPTO_BAM_SW_VERSION_ADDR A:0x641c5004
y.create.l HWIO_MSS_CRYPTO_BAM_NUM_PIPES_ADDR A:0x641c5008
y.create.l HWIO_MSS_CRYPTO_BAM_TEST_BUS_SEL_ADDR A:0x641c5010
y.create.l HWIO_MSS_CRYPTO_BAM_TEST_BUS_REG_ADDR A:0x641c5014
y.create.l HWIO_MSS_CRYPTO_BAM_AHB_MASTER_ERR_CTRLS_ADDR A:0x641c5024
y.create.l HWIO_MSS_CRYPTO_BAM_AHB_MASTER_ERR_ADDR_ADDR A:0x641c5028
y.create.l HWIO_MSS_CRYPTO_BAM_AHB_MASTER_ERR_DATA_ADDR A:0x641c502c
y.create.l HWIO_MSS_CRYPTO_BAM_AHB_MASTER_ERR_ADDR_LSB_ADDR A:0x641c5100
y.create.l HWIO_MSS_CRYPTO_BAM_AHB_MASTER_ERR_ADDR_MSB_ADDR A:0x641c5104
y.create.l HWIO_MSS_CRYPTO_BAM_TRUST_REG_ADDR A:0x641c6000
y.create.l HWIO_MSS_CRYPTO_BAM_P_TRUST_REG0_ADDR A:0x641c6020
y.create.l HWIO_MSS_CRYPTO_BAM_P_TRUST_REG1_ADDR A:0x641c6024
y.create.l HWIO_MSS_CRYPTO_BAM_IRQ_SRCS_EE0_ADDR A:0x641c7000
y.create.l HWIO_MSS_CRYPTO_BAM_IRQ_SRCS_EE1_ADDR A:0x641c8000
y.create.l HWIO_MSS_CRYPTO_BAM_IRQ_SRCS_EE2_ADDR A:0x641c9000
y.create.l HWIO_MSS_CRYPTO_BAM_IRQ_SRCS_EE3_ADDR A:0x641ca000
y.create.l HWIO_MSS_CRYPTO_BAM_IRQ_SRCS_EE4_ADDR A:0x641cb000
y.create.l HWIO_MSS_CRYPTO_BAM_IRQ_SRCS_EE5_ADDR A:0x641cc000
y.create.l HWIO_MSS_CRYPTO_BAM_IRQ_SRCS_EE6_ADDR A:0x641cd000
y.create.l HWIO_MSS_CRYPTO_BAM_IRQ_SRCS_EE7_ADDR A:0x641ce000
y.create.l HWIO_MSS_CRYPTO_BAM_IRQ_SRCS_MSK_EE0_ADDR A:0x641c7004
y.create.l HWIO_MSS_CRYPTO_BAM_IRQ_SRCS_MSK_EE1_ADDR A:0x641c8004
y.create.l HWIO_MSS_CRYPTO_BAM_IRQ_SRCS_MSK_EE2_ADDR A:0x641c9004
y.create.l HWIO_MSS_CRYPTO_BAM_IRQ_SRCS_MSK_EE3_ADDR A:0x641ca004
y.create.l HWIO_MSS_CRYPTO_BAM_IRQ_SRCS_MSK_EE4_ADDR A:0x641cb004
y.create.l HWIO_MSS_CRYPTO_BAM_IRQ_SRCS_MSK_EE5_ADDR A:0x641cc004
y.create.l HWIO_MSS_CRYPTO_BAM_IRQ_SRCS_MSK_EE6_ADDR A:0x641cd004
y.create.l HWIO_MSS_CRYPTO_BAM_IRQ_SRCS_MSK_EE7_ADDR A:0x641ce004
y.create.l HWIO_MSS_CRYPTO_BAM_IRQ_SRCS_UNMASKED_EE0_ADDR A:0x641c7008
y.create.l HWIO_MSS_CRYPTO_BAM_IRQ_SRCS_UNMASKED_EE1_ADDR A:0x641c8008
y.create.l HWIO_MSS_CRYPTO_BAM_IRQ_SRCS_UNMASKED_EE2_ADDR A:0x641c9008
y.create.l HWIO_MSS_CRYPTO_BAM_IRQ_SRCS_UNMASKED_EE3_ADDR A:0x641ca008
y.create.l HWIO_MSS_CRYPTO_BAM_IRQ_SRCS_UNMASKED_EE4_ADDR A:0x641cb008
y.create.l HWIO_MSS_CRYPTO_BAM_IRQ_SRCS_UNMASKED_EE5_ADDR A:0x641cc008
y.create.l HWIO_MSS_CRYPTO_BAM_IRQ_SRCS_UNMASKED_EE6_ADDR A:0x641cd008
y.create.l HWIO_MSS_CRYPTO_BAM_IRQ_SRCS_UNMASKED_EE7_ADDR A:0x641ce008
y.create.l HWIO_MSS_CRYPTO_BAM_PIPE_ATTR_EE0_ADDR A:0x641c700c
y.create.l HWIO_MSS_CRYPTO_BAM_PIPE_ATTR_EE1_ADDR A:0x641c800c
y.create.l HWIO_MSS_CRYPTO_BAM_PIPE_ATTR_EE2_ADDR A:0x641c900c
y.create.l HWIO_MSS_CRYPTO_BAM_PIPE_ATTR_EE3_ADDR A:0x641ca00c
y.create.l HWIO_MSS_CRYPTO_BAM_PIPE_ATTR_EE4_ADDR A:0x641cb00c
y.create.l HWIO_MSS_CRYPTO_BAM_PIPE_ATTR_EE5_ADDR A:0x641cc00c
y.create.l HWIO_MSS_CRYPTO_BAM_PIPE_ATTR_EE6_ADDR A:0x641cd00c
y.create.l HWIO_MSS_CRYPTO_BAM_PIPE_ATTR_EE7_ADDR A:0x641ce00c
y.create.l HWIO_MSS_CRYPTO_BAM_IRQ_SRCS_ADDR A:0x641c7010
y.create.l HWIO_MSS_CRYPTO_BAM_IRQ_SRCS_MSK_ADDR A:0x641c7014
y.create.l HWIO_MSS_CRYPTO_BAM_IRQ_SRCS_UNMASKED_ADDR A:0x641c7018
y.create.l HWIO_MSS_CRYPTO_BAM_P_CTRL0_ADDR A:0x641d7000
y.create.l HWIO_MSS_CRYPTO_BAM_P_CTRL1_ADDR A:0x641d8000
y.create.l HWIO_MSS_CRYPTO_BAM_P_RST0_ADDR A:0x641d7004
y.create.l HWIO_MSS_CRYPTO_BAM_P_RST1_ADDR A:0x641d8004
y.create.l HWIO_MSS_CRYPTO_BAM_P_HALT0_ADDR A:0x641d7008
y.create.l HWIO_MSS_CRYPTO_BAM_P_HALT1_ADDR A:0x641d8008
y.create.l HWIO_MSS_CRYPTO_BAM_P_IRQ_STTS0_ADDR A:0x641d7010
y.create.l HWIO_MSS_CRYPTO_BAM_P_IRQ_STTS1_ADDR A:0x641d8010
y.create.l HWIO_MSS_CRYPTO_BAM_P_IRQ_CLR0_ADDR A:0x641d7014
y.create.l HWIO_MSS_CRYPTO_BAM_P_IRQ_CLR1_ADDR A:0x641d8014
y.create.l HWIO_MSS_CRYPTO_BAM_P_IRQ_EN0_ADDR A:0x641d7018
y.create.l HWIO_MSS_CRYPTO_BAM_P_IRQ_EN1_ADDR A:0x641d8018
y.create.l HWIO_MSS_CRYPTO_BAM_P_TIMER0_ADDR A:0x641d701c
y.create.l HWIO_MSS_CRYPTO_BAM_P_TIMER1_ADDR A:0x641d801c
y.create.l HWIO_MSS_CRYPTO_BAM_P_TIMER_CTRL0_ADDR A:0x641d7020
y.create.l HWIO_MSS_CRYPTO_BAM_P_TIMER_CTRL1_ADDR A:0x641d8020
y.create.l HWIO_MSS_CRYPTO_BAM_P_PRDCR_SDBND0_ADDR A:0x641d7024
y.create.l HWIO_MSS_CRYPTO_BAM_P_PRDCR_SDBND1_ADDR A:0x641d8024
y.create.l HWIO_MSS_CRYPTO_BAM_P_CNSMR_SDBND0_ADDR A:0x641d7028
y.create.l HWIO_MSS_CRYPTO_BAM_P_CNSMR_SDBND1_ADDR A:0x641d8028
y.create.l HWIO_MSS_CRYPTO_BAM_P_SW_OFSTS0_ADDR A:0x641d7800
y.create.l HWIO_MSS_CRYPTO_BAM_P_SW_OFSTS1_ADDR A:0x641d8800
y.create.l HWIO_MSS_CRYPTO_BAM_P_AU_PSM_CNTXT_1_0_ADDR A:0x641d7804
y.create.l HWIO_MSS_CRYPTO_BAM_P_AU_PSM_CNTXT_1_1_ADDR A:0x641d8804
y.create.l HWIO_MSS_CRYPTO_BAM_P_PSM_CNTXT_2_0_ADDR A:0x641d7808
y.create.l HWIO_MSS_CRYPTO_BAM_P_PSM_CNTXT_2_1_ADDR A:0x641d8808
y.create.l HWIO_MSS_CRYPTO_BAM_P_PSM_CNTXT_3_0_ADDR A:0x641d780c
y.create.l HWIO_MSS_CRYPTO_BAM_P_PSM_CNTXT_3_1_ADDR A:0x641d880c
y.create.l HWIO_MSS_CRYPTO_BAM_P_PSM_CNTXT_4_0_ADDR A:0x641d7810
y.create.l HWIO_MSS_CRYPTO_BAM_P_PSM_CNTXT_4_1_ADDR A:0x641d8810
y.create.l HWIO_MSS_CRYPTO_BAM_P_PSM_CNTXT_5_0_ADDR A:0x641d7814
y.create.l HWIO_MSS_CRYPTO_BAM_P_PSM_CNTXT_5_1_ADDR A:0x641d8814
y.create.l HWIO_MSS_CRYPTO_BAM_P_EVNT_REG0_ADDR A:0x641d7818
y.create.l HWIO_MSS_CRYPTO_BAM_P_EVNT_REG1_ADDR A:0x641d8818
y.create.l HWIO_MSS_CRYPTO_BAM_P_DESC_FIFO_ADDR0_ADDR A:0x641d781c
y.create.l HWIO_MSS_CRYPTO_BAM_P_DESC_FIFO_ADDR1_ADDR A:0x641d881c
y.create.l HWIO_MSS_CRYPTO_BAM_P_FIFO_SIZES0_ADDR A:0x641d7820
y.create.l HWIO_MSS_CRYPTO_BAM_P_FIFO_SIZES1_ADDR A:0x641d8820
y.create.l HWIO_MSS_CRYPTO_BAM_P_DATA_FIFO_ADDR0_ADDR A:0x641d7824
y.create.l HWIO_MSS_CRYPTO_BAM_P_DATA_FIFO_ADDR1_ADDR A:0x641d8824
y.create.l HWIO_MSS_CRYPTO_BAM_P_EVNT_GEN_TRSHLD0_ADDR A:0x641d7828
y.create.l HWIO_MSS_CRYPTO_BAM_P_EVNT_GEN_TRSHLD1_ADDR A:0x641d8828
y.create.l HWIO_MSS_CRYPTO_BAM_P_EVNT_DEST_ADDR0_ADDR A:0x641d782c
y.create.l HWIO_MSS_CRYPTO_BAM_P_EVNT_DEST_ADDR1_ADDR A:0x641d882c
y.create.l HWIO_MSS_CRYPTO_BAM_P_DF_CNTXT_0_ADDR A:0x641d7830
y.create.l HWIO_MSS_CRYPTO_BAM_P_DF_CNTXT_1_ADDR A:0x641d8830
y.create.l HWIO_MSS_CRYPTO_BAM_P_RETR_CNTXT_0_ADDR A:0x641d7834
y.create.l HWIO_MSS_CRYPTO_BAM_P_RETR_CNTXT_1_ADDR A:0x641d8834
y.create.l HWIO_MSS_CRYPTO_BAM_P_SI_CNTXT_0_ADDR A:0x641d7838
y.create.l HWIO_MSS_CRYPTO_BAM_P_SI_CNTXT_1_ADDR A:0x641d8838
y.create.l HWIO_MSS_CRYPTO_BAM_P_PSM_CNTXT_3_LSB0_ADDR A:0x641d7900
y.create.l HWIO_MSS_CRYPTO_BAM_P_PSM_CNTXT_3_LSB1_ADDR A:0x641d8900
y.create.l HWIO_MSS_CRYPTO_BAM_P_PSM_CNTXT_3_MSB0_ADDR A:0x641d7904
y.create.l HWIO_MSS_CRYPTO_BAM_P_PSM_CNTXT_3_MSB1_ADDR A:0x641d8904
y.create.l HWIO_MSS_CRYPTO_BAM_P_DESC_FIFO_ADDR_LSB0_ADDR A:0x641d7910
y.create.l HWIO_MSS_CRYPTO_BAM_P_DESC_FIFO_ADDR_LSB1_ADDR A:0x641d8910
y.create.l HWIO_MSS_CRYPTO_BAM_P_DESC_FIFO_ADDR_MSB0_ADDR A:0x641d7914
y.create.l HWIO_MSS_CRYPTO_BAM_P_DESC_FIFO_ADDR_MSB1_ADDR A:0x641d8914
y.create.l HWIO_MSS_CRYPTO_BAM_P_DATA_FIFO_ADDR_LSB0_ADDR A:0x641d7920
y.create.l HWIO_MSS_CRYPTO_BAM_P_DATA_FIFO_ADDR_LSB1_ADDR A:0x641d8920
y.create.l HWIO_MSS_CRYPTO_BAM_P_DATA_FIFO_ADDR_MSB0_ADDR A:0x641d7924
y.create.l HWIO_MSS_CRYPTO_BAM_P_DATA_FIFO_ADDR_MSB1_ADDR A:0x641d8924
y.create.l HWIO_MSS_CRYPTO_BAM_P_EVNT_DEST_ADDR_LSB0_ADDR A:0x641d7930
y.create.l HWIO_MSS_CRYPTO_BAM_P_EVNT_DEST_ADDR_LSB1_ADDR A:0x641d8930
y.create.l HWIO_MSS_CRYPTO_BAM_P_EVNT_DEST_ADDR_MSB0_ADDR A:0x641d7934
y.create.l HWIO_MSS_CRYPTO_BAM_P_EVNT_DEST_ADDR_MSB1_ADDR A:0x641d8934
y.create.l HWIO_MSS_RC_CONTROL_ADDR A:0x64200000
y.create.l HWIO_MSS_RC_CONFIG_ADDR A:0x64200004
y.create.l HWIO_MSS_RC_LPM_RTC_CONTROL_ADDR A:0x64200008
y.create.l HWIO_MSS_RC_PPSO_ASSERT_ADDR A:0x6420000c
y.create.l HWIO_MSS_RC_PPSO_DEASSERT_ADDR A:0x64200010
y.create.l HWIO_MSS_RC_GPS_ON_ADDR A:0x64200014
y.create.l HWIO_MSS_RC_TIME_TRANSFER_ADDR A:0x64200018
y.create.l HWIO_MSS_RC_GNSS_RTC_STATUS_ADDR A:0x6420001c
y.create.l HWIO_MSS_RC_BP1_COUNT_STATUS_ADDR A:0x64200020
y.create.l HWIO_MSS_RC_BP1_PHASE_STATUS_ADDR A:0x64200024
y.create.l HWIO_MSS_RC_BP2_COUNT_STATUS_ADDR A:0x64200028
y.create.l HWIO_MSS_RC_BP2_PHASE_STATUS_ADDR A:0x6420002c
y.create.l HWIO_MSS_RC_BP3_COUNT_STATUS_ADDR A:0x64200030
y.create.l HWIO_MSS_RC_BP3_PHASE_STATUS_ADDR A:0x64200034
y.create.l HWIO_MSS_RC_BP4_COUNT_STATUS_ADDR A:0x64200038
y.create.l HWIO_MSS_RC_BP4_PHASE_STATUS_ADDR A:0x6420003c
y.create.l HWIO_MSS_RC_TT_STATUS_ADDR A:0x64200040
y.create.l HWIO_MSS_RC_IRQ_STATUS_ADDR A:0x64200044
y.create.l HWIO_MSS_RC_PPSI_RTC_ADDR A:0x64200048
y.create.l HWIO_MSS_RC_NAV_TT_RTC_ADDR A:0x6420004c
y.create.l HWIO_MSS_RC_CDMA_TT_RTC_ADDR A:0x64200050
y.create.l HWIO_MSS_RC_GNSS_TT_CNT_ADDR A:0x64200054
y.create.l HWIO_MSS_RC_NAV_TEST_BUS_ADDR A:0x64200058
y.create.l HWIO_MSS_RC_B1_POLYNOMIAL_MASK_ADDR A:0x6420005c
y.create.l HWIO_MSS_AD_MODE_ADDR A:0x64200080
y.create.l HWIO_MSS_AD_RX1_CONFIG_ADDR A:0x64200084
y.create.l HWIO_MSS_AD_RX2_CONFIG_ADDR A:0x64200088
y.create.l HWIO_MSS_AD_RX1_QUANTMAP_ADDR A:0x6420008c
y.create.l HWIO_MSS_AD_RX2_QUANTMAP_ADDR A:0x64200090
y.create.l HWIO_MSS_AD_MEAS_STATUS_ADDR A:0x64200094
y.create.l HWIO_MSS_AD_RX1_MEAN_MON_ADDR A:0x64200098
y.create.l HWIO_MSS_AD_RX2_MEAN_MON_ADDR A:0x6420009c
y.create.l HWIO_MSS_AD_RX1_BLANK_MONITOR_ADDR A:0x642000a0
y.create.l HWIO_MSS_AD_RX2_BLANK_MONITOR_ADDR A:0x642000a4
y.create.l HWIO_MSS_AD_SL_INDEX_ADDR A:0x642000a8
y.create.l HWIO_MSS_AD_RX1_AMPL_MON_ADDR A:0x642000ac
y.create.l HWIO_MSS_AD_RX2_AMPL_MON_ADDR A:0x642000b0
y.create.l HWIO_MSS_AD_SPEC_ANALYZER_CMD_ADDR A:0x642000b4
y.create.l HWIO_MSS_AD_SPEC_ANALYZER_STATUS_ADDR A:0x642000b8
y.create.l HWIO_MSS_BP1_CONFIG_ADDR A:0x64200200
y.create.l HWIO_MSS_BP1_IF_FREQ_ADDR A:0x64200204
y.create.l HWIO_MSS_BP1_RS_RATE_ADDR A:0x64200208
y.create.l HWIO_MSS_BP1_OFFSET_ADDR A:0x6420020c
y.create.l HWIO_MSS_BP1_NOTCH1_ADDR A:0x64200210
y.create.l HWIO_MSS_BP1_NOTCH2_ADDR A:0x64200214
y.create.l HWIO_MSS_BP1_NOTCH3_ADDR A:0x64200218
y.create.l HWIO_MSS_BP1_NOTCH4_ADDR A:0x6420021c
y.create.l HWIO_MSS_BP1_NOTCH5_ADDR A:0x64200220
y.create.l HWIO_MSS_BP1_NOTCH6_ADDR A:0x64200224
y.create.l HWIO_MSS_BP1_EQ_COEF_REAL_ADDR A:0x64200228
y.create.l HWIO_MSS_BP1_EQ_COEF_IMAG_ADDR A:0x6420022c
y.create.l HWIO_MSS_BP1_FREQ_ADDR A:0x64200230
y.create.l HWIO_MSS_BP1_THRESH_ADDR A:0x64200234
y.create.l HWIO_MSS_BP1_PRE_NOTCH_ADDR A:0x64200238
y.create.l HWIO_MSS_BP1_RS_PHASE_ADDR A:0x6420023c
y.create.l HWIO_MSS_BP1_PRE_AMPL_MON_ADDR A:0x64200240
y.create.l HWIO_MSS_BP1_MEAN_MON_ADDR A:0x64200244
y.create.l HWIO_MSS_BP1_SCH2_AMPL_MON_ADDR A:0x64200248
y.create.l HWIO_MSS_BP1_SCH3_AMPL_MON_ADDR A:0x6420024c
y.create.l HWIO_MSS_BP2_CONFIG_ADDR A:0x64200300
y.create.l HWIO_MSS_BP2_IF_FREQ_ADDR A:0x64200304
y.create.l HWIO_MSS_BP2_RS_RATE_ADDR A:0x64200308
y.create.l HWIO_MSS_BP2_OFFSET_ADDR A:0x6420030c
y.create.l HWIO_MSS_BP2_NOTCH1_ADDR A:0x64200310
y.create.l HWIO_MSS_BP2_NOTCH2_ADDR A:0x64200314
y.create.l HWIO_MSS_BP2_NOTCH3_ADDR A:0x64200318
y.create.l HWIO_MSS_BP2_NOTCH4_ADDR A:0x6420031c
y.create.l HWIO_MSS_BP2_NOTCH5_ADDR A:0x64200320
y.create.l HWIO_MSS_BP2_NOTCH6_ADDR A:0x64200324
y.create.l HWIO_MSS_BP2_EQ_COEF_REAL_ADDR A:0x64200328
y.create.l HWIO_MSS_BP2_EQ_COEF_IMAG_ADDR A:0x6420032c
y.create.l HWIO_MSS_BP2_FREQ_ADDR A:0x64200330
y.create.l HWIO_MSS_BP2_THRESH_ADDR A:0x64200334
y.create.l HWIO_MSS_BP2_PRE_NOTCH_ADDR A:0x64200338
y.create.l HWIO_MSS_BP2_RS_PHASE_ADDR A:0x6420033c
y.create.l HWIO_MSS_BP2_PRE_AMPL_MON_ADDR A:0x64200340
y.create.l HWIO_MSS_BP2_MEAN_MON_ADDR A:0x64200344
y.create.l HWIO_MSS_BP2_SCH2_AMPL_MON_ADDR A:0x64200348
y.create.l HWIO_MSS_BP2_SCH3_AMPL_MON_ADDR A:0x6420034c
y.create.l HWIO_MSS_BP3_CONFIG_ADDR A:0x64200400
y.create.l HWIO_MSS_BP3_IF_FREQ_ADDR A:0x64200404
y.create.l HWIO_MSS_BP3_RS_RATE_ADDR A:0x64200408
y.create.l HWIO_MSS_BP3_OFFSET_ADDR A:0x6420040c
y.create.l HWIO_MSS_BP3_NOTCH1_ADDR A:0x64200410
y.create.l HWIO_MSS_BP3_NOTCH2_ADDR A:0x64200414
y.create.l HWIO_MSS_BP3_NOTCH3_ADDR A:0x64200418
y.create.l HWIO_MSS_BP3_NOTCH4_ADDR A:0x6420041c
y.create.l HWIO_MSS_BP3_NOTCH5_ADDR A:0x64200420
y.create.l HWIO_MSS_BP3_NOTCH6_ADDR A:0x64200424
y.create.l HWIO_MSS_BP3_EQ_COEF_REAL_ADDR A:0x64200428
y.create.l HWIO_MSS_BP3_EQ_COEF_IMAG_ADDR A:0x6420042c
y.create.l HWIO_MSS_BP3_RS_PHASE_ADDR A:0x64200430
y.create.l HWIO_MSS_BP3_SCH1_FREQ_ADDR A:0x64200434
y.create.l HWIO_MSS_BP3_SCH2_FREQ_ADDR A:0x64200438
y.create.l HWIO_MSS_BP3_SCH3_FREQ_ADDR A:0x6420043c
y.create.l HWIO_MSS_BP3_SCH4_FREQ_ADDR A:0x64200440
y.create.l HWIO_MSS_BP3_SCH5_FREQ_ADDR A:0x64200444
y.create.l HWIO_MSS_BP3_SCH6_FREQ_ADDR A:0x64200448
y.create.l HWIO_MSS_BP3_SCH7_FREQ_ADDR A:0x6420044c
y.create.l HWIO_MSS_BP3_SCH8_FREQ_ADDR A:0x64200450
y.create.l HWIO_MSS_BP3_SCH9_FREQ_ADDR A:0x64200454
y.create.l HWIO_MSS_BP3_SCH10_FREQ_ADDR A:0x64200458
y.create.l HWIO_MSS_BP3_SCH11_FREQ_ADDR A:0x6420045c
y.create.l HWIO_MSS_BP3_SCH12_FREQ_ADDR A:0x64200460
y.create.l HWIO_MSS_BP3_THRESH_A_ADDR A:0x64200464
y.create.l HWIO_MSS_BP3_THRESH_B_ADDR A:0x64200468
y.create.l HWIO_MSS_BP3_THRESH_C_ADDR A:0x6420046c
y.create.l HWIO_MSS_BP3_THRESH_D_ADDR A:0x64200470
y.create.l HWIO_MSS_BP3_THRESH_E_ADDR A:0x64200474
y.create.l HWIO_MSS_BP3_THRESH_F_ADDR A:0x64200478
y.create.l HWIO_MSS_BP3_PRE_AMPL_MON_ADDR A:0x6420047c
y.create.l HWIO_MSS_BP3_MEAN_MON_ADDR A:0x64200480
y.create.l HWIO_MSS_BP3_SCH1_AMPL_MON_ADDR A:0x64200484
y.create.l HWIO_MSS_BP3_SCH2_AMPL_MON_ADDR A:0x64200488
y.create.l HWIO_MSS_BP3_SCH3_AMPL_MON_ADDR A:0x6420048c
y.create.l HWIO_MSS_BP3_SCH4_AMPL_MON_ADDR A:0x64200490
y.create.l HWIO_MSS_BP3_SCH5_AMPL_MON_ADDR A:0x64200494
y.create.l HWIO_MSS_BP3_SCH6_AMPL_MON_ADDR A:0x64200498
y.create.l HWIO_MSS_BP3_SCH7_AMPL_MON_ADDR A:0x6420049c
y.create.l HWIO_MSS_BP3_SCH8_AMPL_MON_ADDR A:0x642004a0
y.create.l HWIO_MSS_BP3_SCH9_AMPL_MON_ADDR A:0x642004a4
y.create.l HWIO_MSS_BP3_SCH10_AMPL_MON_ADDR A:0x642004a8
y.create.l HWIO_MSS_BP3_SCH11_AMPL_MON_ADDR A:0x642004ac
y.create.l HWIO_MSS_BP3_SCH12_AMPL_MON_ADDR A:0x642004b0
y.create.l HWIO_MSS_BP3_SCH_MODE_ADDR A:0x642004b4
y.create.l HWIO_MSS_BP3_PRE_NOTCH_ADDR A:0x642004b8
y.create.l HWIO_MSS_BP3_NOTCH7_ADDR A:0x642004bc
y.create.l HWIO_MSS_BP3_NOTCH8_ADDR A:0x642004c0
y.create.l HWIO_MSS_BP3_NOTCH9_ADDR A:0x642004c4
y.create.l HWIO_MSS_BP3_NOTCH10_ADDR A:0x642004c8
y.create.l HWIO_MSS_BP3_NOTCH11_ADDR A:0x642004cc
y.create.l HWIO_MSS_BP3_NOTCH12_ADDR A:0x642004d0
y.create.l HWIO_MSS_BP4_CONFIG_ADDR A:0x64200500
y.create.l HWIO_MSS_BP4_IF_FREQ_ADDR A:0x64200504
y.create.l HWIO_MSS_BP4_RS_RATE_ADDR A:0x64200508
y.create.l HWIO_MSS_BP4_OFFSET_ADDR A:0x6420050c
y.create.l HWIO_MSS_BP4_NOTCH1_ADDR A:0x64200510
y.create.l HWIO_MSS_BP4_NOTCH2_ADDR A:0x64200514
y.create.l HWIO_MSS_BP4_NOTCH3_ADDR A:0x64200518
y.create.l HWIO_MSS_BP4_NOTCH4_ADDR A:0x6420051c
y.create.l HWIO_MSS_BP4_NOTCH5_ADDR A:0x64200520
y.create.l HWIO_MSS_BP4_NOTCH6_ADDR A:0x64200524
y.create.l HWIO_MSS_BP4_EQ_COEF_REAL_ADDR A:0x64200528
y.create.l HWIO_MSS_BP4_EQ_COEF_IMAG_ADDR A:0x6420052c
y.create.l HWIO_MSS_BP4_FREQ_ADDR A:0x64200530
y.create.l HWIO_MSS_BP4_THRESH_ADDR A:0x64200534
y.create.l HWIO_MSS_BP4_RS_PHASE_ADDR A:0x64200538
y.create.l HWIO_MSS_BP4_PRE_AMPL_MON_ADDR A:0x6420053c
y.create.l HWIO_MSS_BP4_MEAN_MON_ADDR A:0x64200540
y.create.l HWIO_MSS_BP4_AMPL_MON_ADDR A:0x64200544
y.create.l HWIO_MSS_BP4_PRE_NOTCH_ADDR A:0x64200548
y.create.l HWIO_MSS_LTE1_CONFIG_ADDR A:0x642002e0
y.create.l HWIO_MSS_LTE1_IF_FREQ_ADDR A:0x642002e4
y.create.l HWIO_MSS_LTE3_CONFIG_ADDR A:0x642004e0
y.create.l HWIO_MSS_LTE3_IF_FREQ_ADDR A:0x642004e4
y.create.l HWIO_MSS_TSG_CMD0_ADDR A:0x64200100
y.create.l HWIO_MSS_TSG_CH1_CONFIG_ADDR A:0x64200104
y.create.l HWIO_MSS_TSG_CH1_RS_RATE_ADDR A:0x64200108
y.create.l HWIO_MSS_TSG_CH1_INIT_COUNT_ADDR A:0x6420010c
y.create.l HWIO_MSS_TSG_CH1_FREQ_ADDR A:0x64200110
y.create.l HWIO_MSS_TSG_CH1_DATA_SEED_ADDR A:0x64200114
y.create.l HWIO_MSS_TSG_CH1_PILOT_SEED_ADDR A:0x64200118
y.create.l HWIO_MSS_TSG_CH2_CONFIG_ADDR A:0x6420011c
y.create.l HWIO_MSS_TSG_CH2_RS_RATE_ADDR A:0x64200120
y.create.l HWIO_MSS_TSG_CH2_INIT_COUNT_ADDR A:0x64200124
y.create.l HWIO_MSS_TSG_CH2_FREQ_ADDR A:0x64200128
y.create.l HWIO_MSS_TSG_CH2_DATA_SEED_ADDR A:0x6420012c
y.create.l HWIO_MSS_TSG_CH2_PILOT_SEED_ADDR A:0x64200130
y.create.l HWIO_MSS_TSG_RX1_CONFIG_ADDR A:0x64200134
y.create.l HWIO_MSS_TSG_RX1_OFFSET_ADDR A:0x64200138
y.create.l HWIO_MSS_TSG_RX2_CONFIG_ADDR A:0x6420013c
y.create.l HWIO_MSS_TSG_RX2_OFFSET_ADDR A:0x64200140
y.create.l HWIO_MSS_TSG_FIRST_CODE_ADDR A:0x64200144
y.create.l HWIO_MSS_TSG_CH1_COUNT_STATUS_ADDR A:0x64200148
y.create.l HWIO_MSS_TSG_CH2_COUNT_STATUS_ADDR A:0x6420014c
y.create.l HWIO_MSS_SMI_MODE_ADDR A:0x64200600
y.create.l HWIO_MSS_SMI_BASEADDR1_ADDR A:0x64200604
y.create.l HWIO_MSS_SMI_BASEADDR2_ADDR A:0x64200608
y.create.l HWIO_MSS_SMI_BASEADDR3A_ADDR A:0x6420060c
y.create.l HWIO_MSS_SMI_BASEADDR3B_ADDR A:0x64200610
y.create.l HWIO_MSS_SMI_BASEADDR3C_ADDR A:0x64200614
y.create.l HWIO_MSS_SMI_BASEADDR4_ADDR A:0x64200618
y.create.l HWIO_MSS_CP_START_ADDR A:0x64200700
y.create.l HWIO_MSS_CP_CONFIG1_ADDR A:0x64200704
y.create.l HWIO_MSS_CP_CONFIG2_ADDR A:0x64200708
y.create.l HWIO_MSS_CP_SAMPLE_INDEX_ADDR A:0x6420070c
y.create.l HWIO_MSS_CP_PHASE_ADDR A:0x64200710
y.create.l HWIO_MSS_CP_FREQ_ADDR A:0x64200714
y.create.l HWIO_MSS_CP_DATA_SEED_ADDR A:0x64200718
y.create.l HWIO_MSS_CP_PILOT_SEED_ADDR A:0x6420071c
y.create.l HWIO_MSS_CP_CODE_INDEX_ADDR A:0x64200720
y.create.l HWIO_MSS_CP_COEF1_ADDR A:0x64200724
y.create.l HWIO_MSS_CP_COEF2_ADDR A:0x64200728
y.create.l HWIO_MSS_CP_COEF3_ADDR A:0x6420072c
y.create.l HWIO_MSS_CP_COEF4_ADDR A:0x64200730
y.create.l HWIO_MSS_CP_COEF5_ADDR A:0x64200734
y.create.l HWIO_MSS_CP_COEF6_ADDR A:0x64200738
y.create.l HWIO_MSS_CP_STATUS_ADDR A:0x6420073c
y.create.l HWIO_MSS_CCP_BREAKPOINT_ADDR A:0x64200800
y.create.l HWIO_MSS_CCP_BREAK_STATE_ADDR A:0x64200804
y.create.l HWIO_MSS_CCP_PROG_STATUS_ADDR A:0x64200808
y.create.l HWIO_MSS_CCP_G10_STATUS_ADDR A:0x6420080c
y.create.l HWIO_MSS_CCP_G32_STATUS_ADDR A:0x64200810
y.create.l HWIO_MSS_CCP_G54_STATUS_ADDR A:0x64200814
y.create.l HWIO_MSS_CCP_G76_STATUS_ADDR A:0x64200818
y.create.l HWIO_MSS_CCP_P10_STATUS_ADDR A:0x6420081c
y.create.l HWIO_MSS_CCP_P2_STATUS_ADDR A:0x64200820
y.create.l HWIO_MSS_SM_ADDR_BEGIN_ADDR A:0x64240000
y.create.l HWIO_MSS_SM_ADDR_END_ADDR A:0x64256ffc
y.create.l HWIO_MSS_GPM_ADDR_BEGIN_ADDR A:0x64204000
y.create.l HWIO_MSS_GPM_ADDR_END_ADDR A:0x642047fc
y.create.l HWIO_MSS_GDM_ADDR_BEGIN_ADDR A:0x64208000
y.create.l HWIO_MSS_GDM_ADDR_END_ADDR A:0x642087fc
y.create.l HWIO_MSS_CMA_ADDR_BEGIN_ADDR A:0x6420c000
y.create.l HWIO_MSS_CMA_ADDR_END_ADDR A:0x6420edfc
y.create.l HWIO_MSS_CMB_ADDR_BEGIN_ADDR A:0x64210000
y.create.l HWIO_MSS_CMB_ADDR_END_ADDR A:0x64212dfc
y.create.l HWIO_MSS_VM_ADDR_BEGIN_ADDR A:0x64218000
y.create.l HWIO_MSS_VM_ADDR_END_ADDR A:0x64218ffc
y.create.l HWIO_MSS_PM_ADDR_BEGIN_ADDR A:0x6421c000
y.create.l HWIO_MSS_PM_ADDR_END_ADDR A:0x6421cffc
y.create.l HWIO_MSS_CCM_START_CMD_ADDR A:0x64214000
y.create.l HWIO_MSS_CCM_WORD1_CMD_ADDR A:0x64214004
y.create.l HWIO_MSS_CCM_WORD2_CMD_ADDR A:0x64214008
y.create.l HWIO_MSS_CCM_WORD3_CMD_ADDR A:0x6421400c
y.create.l HWIO_MSS_CCM_WORD4_CMD_ADDR A:0x64214010
y.create.l HWIO_MSS_CCM_WORD5_CMD_ADDR A:0x64214014
y.create.l HWIO_MSS_CCM_WORD6_CMD_ADDR A:0x64214018
y.create.l HWIO_MSS_CCM_WORD7_CMD_ADDR A:0x6421401c
y.create.l HWIO_MSS_CCM_END_CMD_ADDR A:0x64214020
y.create.l HWIO_MSS_CCM_STOP_CMD_ADDR A:0x642147dc
y.create.l HWIO_MSS_CCM_LOAD_CMD_ADDR A:0x642147e0
y.create.l HWIO_MSS_CCM_ERROR_CLEAR_CMD_ADDR A:0x642147e4
y.create.l HWIO_MSS_CCM_TIME_MARGIN_CMD_ADDR A:0x642147e8
y.create.l HWIO_MSS_CCM_LATE_TASK_ERROR_STATUS_ADDR A:0x642147ec
y.create.l HWIO_MSS_CCM_OVERRUN_ERROR_STATUS_ADDR A:0x642147f0
y.create.l HWIO_MSS_CCM_SEQ_NUMBER_STATUS_ADDR A:0x642147f4
y.create.l HWIO_MSS_CCM_DONE_RTC_STATUS_ADDR A:0x642147f8
y.create.l HWIO_MSS_CCM_STALL_COUNT_STATUS_ADDR A:0x642147fc
y.create.l HWIO_MSS_TPM_ADDR_BEGIN_ADDR A:0x64220000
y.create.l HWIO_MSS_TPM_ADDR_END_ADDR A:0x642201fc
y.create.l HWIO_MSS_TDM_ADDR_BEGIN_ADDR A:0x64224000
y.create.l HWIO_MSS_TDM_ADDR_END_ADDR A:0x642241fc
y.create.l HWIO_MSS_GACC_CLK_CTL_ADDR A:0x64200a00
y.create.l HWIO_MSS_GACC_RTC_WAIT_ADDR A:0x64200a04
y.create.l HWIO_MSS_GACC_START_ADDR_ADDR A:0x64200a08
y.create.l HWIO_MSS_GACC_COUNT_ADDR A:0x64200a0c
y.create.l HWIO_MSS_GACC_INCR_ADDR A:0x64200a10
y.create.l HWIO_MSS_GACC_FREQ_ADDR A:0x64200a14
y.create.l HWIO_MSS_GACC_CONFIG_ADDR A:0x64200a18
y.create.l HWIO_MSS_GACC_PEAK_ADDR A:0x64200a1c
y.create.l HWIO_MSS_GACC_DONE_ADDR A:0x64200a20
y.create.l HWIO_MSS_GACC_RTC_ADDR A:0x64200a24
y.create.l HWIO_MSS_GACC_TEST_BUS_OUT_ADDR A:0x64200a28
y.create.l HWIO_MSS_GACC_SAMPLE_MEM_START_ADDR_ADDR A:0x64228000
y.create.l HWIO_MSS_GACC_SAMPLE_MEM_END_ADDR_ADDR A:0x642289fc
y.create.l HWIO_MSS_GACC_ENERGY_MEM_START_ADDR_ADDR A:0x6422c000
y.create.l HWIO_MSS_GACC_ENERGY_MEM_END_ADDR_ADDR A:0x6422c9fc
y.create.l HWIO_MSS_HI0_CH0_CMD_PTR_SD0_ADDR A:0x64200b00
y.create.l HWIO_MSS_HI0_CH0_CMD_PTR_SD1_ADDR A:0x64200f00
y.create.l HWIO_MSS_HI0_CH0_CMD_PTR_SD2_ADDR A:0x64201300
y.create.l HWIO_MSS_HI0_CH0_CMD_PTR_SD3_ADDR A:0x64201700
y.create.l HWIO_MSS_HI0_CH1_CMD_PTR_SD0_ADDR A:0x64200b04
y.create.l HWIO_MSS_HI0_CH1_CMD_PTR_SD1_ADDR A:0x64200f04
y.create.l HWIO_MSS_HI0_CH1_CMD_PTR_SD2_ADDR A:0x64201304
y.create.l HWIO_MSS_HI0_CH1_CMD_PTR_SD3_ADDR A:0x64201704
y.create.l HWIO_MSS_HI0_CH2_CMD_PTR_SD0_ADDR A:0x64200b08
y.create.l HWIO_MSS_HI0_CH2_CMD_PTR_SD1_ADDR A:0x64200f08
y.create.l HWIO_MSS_HI0_CH2_CMD_PTR_SD2_ADDR A:0x64201308
y.create.l HWIO_MSS_HI0_CH2_CMD_PTR_SD3_ADDR A:0x64201708
y.create.l HWIO_MSS_HI0_CH3_CMD_PTR_SD0_ADDR A:0x64200b0c
y.create.l HWIO_MSS_HI0_CH3_CMD_PTR_SD1_ADDR A:0x64200f0c
y.create.l HWIO_MSS_HI0_CH3_CMD_PTR_SD2_ADDR A:0x6420130c
y.create.l HWIO_MSS_HI0_CH3_CMD_PTR_SD3_ADDR A:0x6420170c
y.create.l HWIO_MSS_HI0_CH4_CMD_PTR_SD0_ADDR A:0x64200b10
y.create.l HWIO_MSS_HI0_CH4_CMD_PTR_SD1_ADDR A:0x64200f10
y.create.l HWIO_MSS_HI0_CH4_CMD_PTR_SD2_ADDR A:0x64201310
y.create.l HWIO_MSS_HI0_CH4_CMD_PTR_SD3_ADDR A:0x64201710
y.create.l HWIO_MSS_HI0_CH5_CMD_PTR_SD0_ADDR A:0x64200b14
y.create.l HWIO_MSS_HI0_CH5_CMD_PTR_SD1_ADDR A:0x64200f14
y.create.l HWIO_MSS_HI0_CH5_CMD_PTR_SD2_ADDR A:0x64201314
y.create.l HWIO_MSS_HI0_CH5_CMD_PTR_SD3_ADDR A:0x64201714
y.create.l HWIO_MSS_HI0_CH6_CMD_PTR_SD0_ADDR A:0x64200b18
y.create.l HWIO_MSS_HI0_CH6_CMD_PTR_SD1_ADDR A:0x64200f18
y.create.l HWIO_MSS_HI0_CH6_CMD_PTR_SD2_ADDR A:0x64201318
y.create.l HWIO_MSS_HI0_CH6_CMD_PTR_SD3_ADDR A:0x64201718
y.create.l HWIO_MSS_HI0_CH7_CMD_PTR_SD0_ADDR A:0x64200b1c
y.create.l HWIO_MSS_HI0_CH7_CMD_PTR_SD1_ADDR A:0x64200f1c
y.create.l HWIO_MSS_HI0_CH7_CMD_PTR_SD2_ADDR A:0x6420131c
y.create.l HWIO_MSS_HI0_CH7_CMD_PTR_SD3_ADDR A:0x6420171c
y.create.l HWIO_MSS_HI0_CH0_RSLT_SD0_ADDR A:0x64200b40
y.create.l HWIO_MSS_HI0_CH0_RSLT_SD1_ADDR A:0x64200f40
y.create.l HWIO_MSS_HI0_CH0_RSLT_SD2_ADDR A:0x64201340
y.create.l HWIO_MSS_HI0_CH0_RSLT_SD3_ADDR A:0x64201740
y.create.l HWIO_MSS_HI0_CH1_RSLT_SD0_ADDR A:0x64200b44
y.create.l HWIO_MSS_HI0_CH1_RSLT_SD1_ADDR A:0x64200f44
y.create.l HWIO_MSS_HI0_CH1_RSLT_SD2_ADDR A:0x64201344
y.create.l HWIO_MSS_HI0_CH1_RSLT_SD3_ADDR A:0x64201744
y.create.l HWIO_MSS_HI0_CH2_RSLT_SD0_ADDR A:0x64200b48
y.create.l HWIO_MSS_HI0_CH2_RSLT_SD1_ADDR A:0x64200f48
y.create.l HWIO_MSS_HI0_CH2_RSLT_SD2_ADDR A:0x64201348
y.create.l HWIO_MSS_HI0_CH2_RSLT_SD3_ADDR A:0x64201748
y.create.l HWIO_MSS_HI0_CH3_RSLT_SD0_ADDR A:0x64200b4c
y.create.l HWIO_MSS_HI0_CH3_RSLT_SD1_ADDR A:0x64200f4c
y.create.l HWIO_MSS_HI0_CH3_RSLT_SD2_ADDR A:0x6420134c
y.create.l HWIO_MSS_HI0_CH3_RSLT_SD3_ADDR A:0x6420174c
y.create.l HWIO_MSS_HI0_CH4_RSLT_SD0_ADDR A:0x64200b50
y.create.l HWIO_MSS_HI0_CH4_RSLT_SD1_ADDR A:0x64200f50
y.create.l HWIO_MSS_HI0_CH4_RSLT_SD2_ADDR A:0x64201350
y.create.l HWIO_MSS_HI0_CH4_RSLT_SD3_ADDR A:0x64201750
y.create.l HWIO_MSS_HI0_CH5_RSLT_SD0_ADDR A:0x64200b54
y.create.l HWIO_MSS_HI0_CH5_RSLT_SD1_ADDR A:0x64200f54
y.create.l HWIO_MSS_HI0_CH5_RSLT_SD2_ADDR A:0x64201354
y.create.l HWIO_MSS_HI0_CH5_RSLT_SD3_ADDR A:0x64201754
y.create.l HWIO_MSS_HI0_CH6_RSLT_SD0_ADDR A:0x64200b58
y.create.l HWIO_MSS_HI0_CH6_RSLT_SD1_ADDR A:0x64200f58
y.create.l HWIO_MSS_HI0_CH6_RSLT_SD2_ADDR A:0x64201358
y.create.l HWIO_MSS_HI0_CH6_RSLT_SD3_ADDR A:0x64201758
y.create.l HWIO_MSS_HI0_CH7_RSLT_SD0_ADDR A:0x64200b5c
y.create.l HWIO_MSS_HI0_CH7_RSLT_SD1_ADDR A:0x64200f5c
y.create.l HWIO_MSS_HI0_CH7_RSLT_SD2_ADDR A:0x6420135c
y.create.l HWIO_MSS_HI0_CH7_RSLT_SD3_ADDR A:0x6420175c
y.create.l HWIO_MSS_HI0_CH0_FLUSH_STATE0_SD0_ADDR A:0x64200b80
y.create.l HWIO_MSS_HI0_CH0_FLUSH_STATE0_SD1_ADDR A:0x64200f80
y.create.l HWIO_MSS_HI0_CH0_FLUSH_STATE0_SD2_ADDR A:0x64201380
y.create.l HWIO_MSS_HI0_CH0_FLUSH_STATE0_SD3_ADDR A:0x64201780
y.create.l HWIO_MSS_HI0_CH1_FLUSH_STATE0_SD0_ADDR A:0x64200b84
y.create.l HWIO_MSS_HI0_CH1_FLUSH_STATE0_SD1_ADDR A:0x64200f84
y.create.l HWIO_MSS_HI0_CH1_FLUSH_STATE0_SD2_ADDR A:0x64201384
y.create.l HWIO_MSS_HI0_CH1_FLUSH_STATE0_SD3_ADDR A:0x64201784
y.create.l HWIO_MSS_HI0_CH2_FLUSH_STATE0_SD0_ADDR A:0x64200b88
y.create.l HWIO_MSS_HI0_CH2_FLUSH_STATE0_SD1_ADDR A:0x64200f88
y.create.l HWIO_MSS_HI0_CH2_FLUSH_STATE0_SD2_ADDR A:0x64201388
y.create.l HWIO_MSS_HI0_CH2_FLUSH_STATE0_SD3_ADDR A:0x64201788
y.create.l HWIO_MSS_HI0_CH3_FLUSH_STATE0_SD0_ADDR A:0x64200b8c
y.create.l HWIO_MSS_HI0_CH3_FLUSH_STATE0_SD1_ADDR A:0x64200f8c
y.create.l HWIO_MSS_HI0_CH3_FLUSH_STATE0_SD2_ADDR A:0x6420138c
y.create.l HWIO_MSS_HI0_CH3_FLUSH_STATE0_SD3_ADDR A:0x6420178c
y.create.l HWIO_MSS_HI0_CH4_FLUSH_STATE0_SD0_ADDR A:0x64200b90
y.create.l HWIO_MSS_HI0_CH4_FLUSH_STATE0_SD1_ADDR A:0x64200f90
y.create.l HWIO_MSS_HI0_CH4_FLUSH_STATE0_SD2_ADDR A:0x64201390
y.create.l HWIO_MSS_HI0_CH4_FLUSH_STATE0_SD3_ADDR A:0x64201790
y.create.l HWIO_MSS_HI0_CH5_FLUSH_STATE0_SD0_ADDR A:0x64200b94
y.create.l HWIO_MSS_HI0_CH5_FLUSH_STATE0_SD1_ADDR A:0x64200f94
y.create.l HWIO_MSS_HI0_CH5_FLUSH_STATE0_SD2_ADDR A:0x64201394
y.create.l HWIO_MSS_HI0_CH5_FLUSH_STATE0_SD3_ADDR A:0x64201794
y.create.l HWIO_MSS_HI0_CH6_FLUSH_STATE0_SD0_ADDR A:0x64200b98
y.create.l HWIO_MSS_HI0_CH6_FLUSH_STATE0_SD1_ADDR A:0x64200f98
y.create.l HWIO_MSS_HI0_CH6_FLUSH_STATE0_SD2_ADDR A:0x64201398
y.create.l HWIO_MSS_HI0_CH6_FLUSH_STATE0_SD3_ADDR A:0x64201798
y.create.l HWIO_MSS_HI0_CH7_FLUSH_STATE0_SD0_ADDR A:0x64200b9c
y.create.l HWIO_MSS_HI0_CH7_FLUSH_STATE0_SD1_ADDR A:0x64200f9c
y.create.l HWIO_MSS_HI0_CH7_FLUSH_STATE0_SD2_ADDR A:0x6420139c
y.create.l HWIO_MSS_HI0_CH7_FLUSH_STATE0_SD3_ADDR A:0x6420179c
y.create.l HWIO_MSS_HI0_CH0_FLUSH_STATE1_SD0_ADDR A:0x64200bc0
y.create.l HWIO_MSS_HI0_CH0_FLUSH_STATE1_SD1_ADDR A:0x64200fc0
y.create.l HWIO_MSS_HI0_CH0_FLUSH_STATE1_SD2_ADDR A:0x642013c0
y.create.l HWIO_MSS_HI0_CH0_FLUSH_STATE1_SD3_ADDR A:0x642017c0
y.create.l HWIO_MSS_HI0_CH1_FLUSH_STATE1_SD0_ADDR A:0x64200bc4
y.create.l HWIO_MSS_HI0_CH1_FLUSH_STATE1_SD1_ADDR A:0x64200fc4
y.create.l HWIO_MSS_HI0_CH1_FLUSH_STATE1_SD2_ADDR A:0x642013c4
y.create.l HWIO_MSS_HI0_CH1_FLUSH_STATE1_SD3_ADDR A:0x642017c4
y.create.l HWIO_MSS_HI0_CH2_FLUSH_STATE1_SD0_ADDR A:0x64200bc8
y.create.l HWIO_MSS_HI0_CH2_FLUSH_STATE1_SD1_ADDR A:0x64200fc8
y.create.l HWIO_MSS_HI0_CH2_FLUSH_STATE1_SD2_ADDR A:0x642013c8
y.create.l HWIO_MSS_HI0_CH2_FLUSH_STATE1_SD3_ADDR A:0x642017c8
y.create.l HWIO_MSS_HI0_CH3_FLUSH_STATE1_SD0_ADDR A:0x64200bcc
y.create.l HWIO_MSS_HI0_CH3_FLUSH_STATE1_SD1_ADDR A:0x64200fcc
y.create.l HWIO_MSS_HI0_CH3_FLUSH_STATE1_SD2_ADDR A:0x642013cc
y.create.l HWIO_MSS_HI0_CH3_FLUSH_STATE1_SD3_ADDR A:0x642017cc
y.create.l HWIO_MSS_HI0_CH4_FLUSH_STATE1_SD0_ADDR A:0x64200bd0
y.create.l HWIO_MSS_HI0_CH4_FLUSH_STATE1_SD1_ADDR A:0x64200fd0
y.create.l HWIO_MSS_HI0_CH4_FLUSH_STATE1_SD2_ADDR A:0x642013d0
y.create.l HWIO_MSS_HI0_CH4_FLUSH_STATE1_SD3_ADDR A:0x642017d0
y.create.l HWIO_MSS_HI0_CH5_FLUSH_STATE1_SD0_ADDR A:0x64200bd4
y.create.l HWIO_MSS_HI0_CH5_FLUSH_STATE1_SD1_ADDR A:0x64200fd4
y.create.l HWIO_MSS_HI0_CH5_FLUSH_STATE1_SD2_ADDR A:0x642013d4
y.create.l HWIO_MSS_HI0_CH5_FLUSH_STATE1_SD3_ADDR A:0x642017d4
y.create.l HWIO_MSS_HI0_CH6_FLUSH_STATE1_SD0_ADDR A:0x64200bd8
y.create.l HWIO_MSS_HI0_CH6_FLUSH_STATE1_SD1_ADDR A:0x64200fd8
y.create.l HWIO_MSS_HI0_CH6_FLUSH_STATE1_SD2_ADDR A:0x642013d8
y.create.l HWIO_MSS_HI0_CH6_FLUSH_STATE1_SD3_ADDR A:0x642017d8
y.create.l HWIO_MSS_HI0_CH7_FLUSH_STATE1_SD0_ADDR A:0x64200bdc
y.create.l HWIO_MSS_HI0_CH7_FLUSH_STATE1_SD1_ADDR A:0x64200fdc
y.create.l HWIO_MSS_HI0_CH7_FLUSH_STATE1_SD2_ADDR A:0x642013dc
y.create.l HWIO_MSS_HI0_CH7_FLUSH_STATE1_SD3_ADDR A:0x642017dc
y.create.l HWIO_MSS_HI0_CH0_FLUSH_STATE3_SD0_ADDR A:0x64200c40
y.create.l HWIO_MSS_HI0_CH0_FLUSH_STATE3_SD1_ADDR A:0x64201040
y.create.l HWIO_MSS_HI0_CH0_FLUSH_STATE3_SD2_ADDR A:0x64201440
y.create.l HWIO_MSS_HI0_CH0_FLUSH_STATE3_SD3_ADDR A:0x64201840
y.create.l HWIO_MSS_HI0_CH1_FLUSH_STATE3_SD0_ADDR A:0x64200c44
y.create.l HWIO_MSS_HI0_CH1_FLUSH_STATE3_SD1_ADDR A:0x64201044
y.create.l HWIO_MSS_HI0_CH1_FLUSH_STATE3_SD2_ADDR A:0x64201444
y.create.l HWIO_MSS_HI0_CH1_FLUSH_STATE3_SD3_ADDR A:0x64201844
y.create.l HWIO_MSS_HI0_CH2_FLUSH_STATE3_SD0_ADDR A:0x64200c48
y.create.l HWIO_MSS_HI0_CH2_FLUSH_STATE3_SD1_ADDR A:0x64201048
y.create.l HWIO_MSS_HI0_CH2_FLUSH_STATE3_SD2_ADDR A:0x64201448
y.create.l HWIO_MSS_HI0_CH2_FLUSH_STATE3_SD3_ADDR A:0x64201848
y.create.l HWIO_MSS_HI0_CH3_FLUSH_STATE3_SD0_ADDR A:0x64200c4c
y.create.l HWIO_MSS_HI0_CH3_FLUSH_STATE3_SD1_ADDR A:0x6420104c
y.create.l HWIO_MSS_HI0_CH3_FLUSH_STATE3_SD2_ADDR A:0x6420144c
y.create.l HWIO_MSS_HI0_CH3_FLUSH_STATE3_SD3_ADDR A:0x6420184c
y.create.l HWIO_MSS_HI0_CH4_FLUSH_STATE3_SD0_ADDR A:0x64200c50
y.create.l HWIO_MSS_HI0_CH4_FLUSH_STATE3_SD1_ADDR A:0x64201050
y.create.l HWIO_MSS_HI0_CH4_FLUSH_STATE3_SD2_ADDR A:0x64201450
y.create.l HWIO_MSS_HI0_CH4_FLUSH_STATE3_SD3_ADDR A:0x64201850
y.create.l HWIO_MSS_HI0_CH5_FLUSH_STATE3_SD0_ADDR A:0x64200c54
y.create.l HWIO_MSS_HI0_CH5_FLUSH_STATE3_SD1_ADDR A:0x64201054
y.create.l HWIO_MSS_HI0_CH5_FLUSH_STATE3_SD2_ADDR A:0x64201454
y.create.l HWIO_MSS_HI0_CH5_FLUSH_STATE3_SD3_ADDR A:0x64201854
y.create.l HWIO_MSS_HI0_CH6_FLUSH_STATE3_SD0_ADDR A:0x64200c58
y.create.l HWIO_MSS_HI0_CH6_FLUSH_STATE3_SD1_ADDR A:0x64201058
y.create.l HWIO_MSS_HI0_CH6_FLUSH_STATE3_SD2_ADDR A:0x64201458
y.create.l HWIO_MSS_HI0_CH6_FLUSH_STATE3_SD3_ADDR A:0x64201858
y.create.l HWIO_MSS_HI0_CH7_FLUSH_STATE3_SD0_ADDR A:0x64200c5c
y.create.l HWIO_MSS_HI0_CH7_FLUSH_STATE3_SD1_ADDR A:0x6420105c
y.create.l HWIO_MSS_HI0_CH7_FLUSH_STATE3_SD2_ADDR A:0x6420145c
y.create.l HWIO_MSS_HI0_CH7_FLUSH_STATE3_SD3_ADDR A:0x6420185c
y.create.l HWIO_MSS_HI0_CH0_FLUSH_STATE4_SD0_ADDR A:0x64200c80
y.create.l HWIO_MSS_HI0_CH0_FLUSH_STATE4_SD1_ADDR A:0x64201080
y.create.l HWIO_MSS_HI0_CH0_FLUSH_STATE4_SD2_ADDR A:0x64201480
y.create.l HWIO_MSS_HI0_CH0_FLUSH_STATE4_SD3_ADDR A:0x64201880
y.create.l HWIO_MSS_HI0_CH1_FLUSH_STATE4_SD0_ADDR A:0x64200c84
y.create.l HWIO_MSS_HI0_CH1_FLUSH_STATE4_SD1_ADDR A:0x64201084
y.create.l HWIO_MSS_HI0_CH1_FLUSH_STATE4_SD2_ADDR A:0x64201484
y.create.l HWIO_MSS_HI0_CH1_FLUSH_STATE4_SD3_ADDR A:0x64201884
y.create.l HWIO_MSS_HI0_CH2_FLUSH_STATE4_SD0_ADDR A:0x64200c88
y.create.l HWIO_MSS_HI0_CH2_FLUSH_STATE4_SD1_ADDR A:0x64201088
y.create.l HWIO_MSS_HI0_CH2_FLUSH_STATE4_SD2_ADDR A:0x64201488
y.create.l HWIO_MSS_HI0_CH2_FLUSH_STATE4_SD3_ADDR A:0x64201888
y.create.l HWIO_MSS_HI0_CH3_FLUSH_STATE4_SD0_ADDR A:0x64200c8c
y.create.l HWIO_MSS_HI0_CH3_FLUSH_STATE4_SD1_ADDR A:0x6420108c
y.create.l HWIO_MSS_HI0_CH3_FLUSH_STATE4_SD2_ADDR A:0x6420148c
y.create.l HWIO_MSS_HI0_CH3_FLUSH_STATE4_SD3_ADDR A:0x6420188c
y.create.l HWIO_MSS_HI0_CH4_FLUSH_STATE4_SD0_ADDR A:0x64200c90
y.create.l HWIO_MSS_HI0_CH4_FLUSH_STATE4_SD1_ADDR A:0x64201090
y.create.l HWIO_MSS_HI0_CH4_FLUSH_STATE4_SD2_ADDR A:0x64201490
y.create.l HWIO_MSS_HI0_CH4_FLUSH_STATE4_SD3_ADDR A:0x64201890
y.create.l HWIO_MSS_HI0_CH5_FLUSH_STATE4_SD0_ADDR A:0x64200c94
y.create.l HWIO_MSS_HI0_CH5_FLUSH_STATE4_SD1_ADDR A:0x64201094
y.create.l HWIO_MSS_HI0_CH5_FLUSH_STATE4_SD2_ADDR A:0x64201494
y.create.l HWIO_MSS_HI0_CH5_FLUSH_STATE4_SD3_ADDR A:0x64201894
y.create.l HWIO_MSS_HI0_CH6_FLUSH_STATE4_SD0_ADDR A:0x64200c98
y.create.l HWIO_MSS_HI0_CH6_FLUSH_STATE4_SD1_ADDR A:0x64201098
y.create.l HWIO_MSS_HI0_CH6_FLUSH_STATE4_SD2_ADDR A:0x64201498
y.create.l HWIO_MSS_HI0_CH6_FLUSH_STATE4_SD3_ADDR A:0x64201898
y.create.l HWIO_MSS_HI0_CH7_FLUSH_STATE4_SD0_ADDR A:0x64200c9c
y.create.l HWIO_MSS_HI0_CH7_FLUSH_STATE4_SD1_ADDR A:0x6420109c
y.create.l HWIO_MSS_HI0_CH7_FLUSH_STATE4_SD2_ADDR A:0x6420149c
y.create.l HWIO_MSS_HI0_CH7_FLUSH_STATE4_SD3_ADDR A:0x6420189c
y.create.l HWIO_MSS_HI0_CH0_FLUSH_STATE5_SD0_ADDR A:0x64200cc0
y.create.l HWIO_MSS_HI0_CH0_FLUSH_STATE5_SD1_ADDR A:0x642010c0
y.create.l HWIO_MSS_HI0_CH0_FLUSH_STATE5_SD2_ADDR A:0x642014c0
y.create.l HWIO_MSS_HI0_CH0_FLUSH_STATE5_SD3_ADDR A:0x642018c0
y.create.l HWIO_MSS_HI0_CH1_FLUSH_STATE5_SD0_ADDR A:0x64200cc4
y.create.l HWIO_MSS_HI0_CH1_FLUSH_STATE5_SD1_ADDR A:0x642010c4
y.create.l HWIO_MSS_HI0_CH1_FLUSH_STATE5_SD2_ADDR A:0x642014c4
y.create.l HWIO_MSS_HI0_CH1_FLUSH_STATE5_SD3_ADDR A:0x642018c4
y.create.l HWIO_MSS_HI0_CH2_FLUSH_STATE5_SD0_ADDR A:0x64200cc8
y.create.l HWIO_MSS_HI0_CH2_FLUSH_STATE5_SD1_ADDR A:0x642010c8
y.create.l HWIO_MSS_HI0_CH2_FLUSH_STATE5_SD2_ADDR A:0x642014c8
y.create.l HWIO_MSS_HI0_CH2_FLUSH_STATE5_SD3_ADDR A:0x642018c8
y.create.l HWIO_MSS_HI0_CH3_FLUSH_STATE5_SD0_ADDR A:0x64200ccc
y.create.l HWIO_MSS_HI0_CH3_FLUSH_STATE5_SD1_ADDR A:0x642010cc
y.create.l HWIO_MSS_HI0_CH3_FLUSH_STATE5_SD2_ADDR A:0x642014cc
y.create.l HWIO_MSS_HI0_CH3_FLUSH_STATE5_SD3_ADDR A:0x642018cc
y.create.l HWIO_MSS_HI0_CH4_FLUSH_STATE5_SD0_ADDR A:0x64200cd0
y.create.l HWIO_MSS_HI0_CH4_FLUSH_STATE5_SD1_ADDR A:0x642010d0
y.create.l HWIO_MSS_HI0_CH4_FLUSH_STATE5_SD2_ADDR A:0x642014d0
y.create.l HWIO_MSS_HI0_CH4_FLUSH_STATE5_SD3_ADDR A:0x642018d0
y.create.l HWIO_MSS_HI0_CH5_FLUSH_STATE5_SD0_ADDR A:0x64200cd4
y.create.l HWIO_MSS_HI0_CH5_FLUSH_STATE5_SD1_ADDR A:0x642010d4
y.create.l HWIO_MSS_HI0_CH5_FLUSH_STATE5_SD2_ADDR A:0x642014d4
y.create.l HWIO_MSS_HI0_CH5_FLUSH_STATE5_SD3_ADDR A:0x642018d4
y.create.l HWIO_MSS_HI0_CH6_FLUSH_STATE5_SD0_ADDR A:0x64200cd8
y.create.l HWIO_MSS_HI0_CH6_FLUSH_STATE5_SD1_ADDR A:0x642010d8
y.create.l HWIO_MSS_HI0_CH6_FLUSH_STATE5_SD2_ADDR A:0x642014d8
y.create.l HWIO_MSS_HI0_CH6_FLUSH_STATE5_SD3_ADDR A:0x642018d8
y.create.l HWIO_MSS_HI0_CH7_FLUSH_STATE5_SD0_ADDR A:0x64200cdc
y.create.l HWIO_MSS_HI0_CH7_FLUSH_STATE5_SD1_ADDR A:0x642010dc
y.create.l HWIO_MSS_HI0_CH7_FLUSH_STATE5_SD2_ADDR A:0x642014dc
y.create.l HWIO_MSS_HI0_CH7_FLUSH_STATE5_SD3_ADDR A:0x642018dc
y.create.l HWIO_MSS_HI0_SEC_DOMAIN_IRQ_STATUS_SD0_ADDR A:0x64200e80
y.create.l HWIO_MSS_HI0_SEC_DOMAIN_IRQ_STATUS_SD1_ADDR A:0x64201280
y.create.l HWIO_MSS_HI0_SEC_DOMAIN_IRQ_STATUS_SD2_ADDR A:0x64201680
y.create.l HWIO_MSS_HI0_SEC_DOMAIN_IRQ_STATUS_SD3_ADDR A:0x64201a80
y.create.l HWIO_MSS_HI0_CH0_RSLT_CONF_SD0_ADDR A:0x64200e00
y.create.l HWIO_MSS_HI0_CH0_RSLT_CONF_SD1_ADDR A:0x64201200
y.create.l HWIO_MSS_HI0_CH0_RSLT_CONF_SD2_ADDR A:0x64201600
y.create.l HWIO_MSS_HI0_CH0_RSLT_CONF_SD3_ADDR A:0x64201a00
y.create.l HWIO_MSS_HI0_CH1_RSLT_CONF_SD0_ADDR A:0x64200e04
y.create.l HWIO_MSS_HI0_CH1_RSLT_CONF_SD1_ADDR A:0x64201204
y.create.l HWIO_MSS_HI0_CH1_RSLT_CONF_SD2_ADDR A:0x64201604
y.create.l HWIO_MSS_HI0_CH1_RSLT_CONF_SD3_ADDR A:0x64201a04
y.create.l HWIO_MSS_HI0_CH2_RSLT_CONF_SD0_ADDR A:0x64200e08
y.create.l HWIO_MSS_HI0_CH2_RSLT_CONF_SD1_ADDR A:0x64201208
y.create.l HWIO_MSS_HI0_CH2_RSLT_CONF_SD2_ADDR A:0x64201608
y.create.l HWIO_MSS_HI0_CH2_RSLT_CONF_SD3_ADDR A:0x64201a08
y.create.l HWIO_MSS_HI0_CH3_RSLT_CONF_SD0_ADDR A:0x64200e0c
y.create.l HWIO_MSS_HI0_CH3_RSLT_CONF_SD1_ADDR A:0x6420120c
y.create.l HWIO_MSS_HI0_CH3_RSLT_CONF_SD2_ADDR A:0x6420160c
y.create.l HWIO_MSS_HI0_CH3_RSLT_CONF_SD3_ADDR A:0x64201a0c
y.create.l HWIO_MSS_HI0_CH4_RSLT_CONF_SD0_ADDR A:0x64200e10
y.create.l HWIO_MSS_HI0_CH4_RSLT_CONF_SD1_ADDR A:0x64201210
y.create.l HWIO_MSS_HI0_CH4_RSLT_CONF_SD2_ADDR A:0x64201610
y.create.l HWIO_MSS_HI0_CH4_RSLT_CONF_SD3_ADDR A:0x64201a10
y.create.l HWIO_MSS_HI0_CH5_RSLT_CONF_SD0_ADDR A:0x64200e14
y.create.l HWIO_MSS_HI0_CH5_RSLT_CONF_SD1_ADDR A:0x64201214
y.create.l HWIO_MSS_HI0_CH5_RSLT_CONF_SD2_ADDR A:0x64201614
y.create.l HWIO_MSS_HI0_CH5_RSLT_CONF_SD3_ADDR A:0x64201a14
y.create.l HWIO_MSS_HI0_CH6_RSLT_CONF_SD0_ADDR A:0x64200e18
y.create.l HWIO_MSS_HI0_CH6_RSLT_CONF_SD1_ADDR A:0x64201218
y.create.l HWIO_MSS_HI0_CH6_RSLT_CONF_SD2_ADDR A:0x64201618
y.create.l HWIO_MSS_HI0_CH6_RSLT_CONF_SD3_ADDR A:0x64201a18
y.create.l HWIO_MSS_HI0_CH7_RSLT_CONF_SD0_ADDR A:0x64200e1c
y.create.l HWIO_MSS_HI0_CH7_RSLT_CONF_SD1_ADDR A:0x6420121c
y.create.l HWIO_MSS_HI0_CH7_RSLT_CONF_SD2_ADDR A:0x6420161c
y.create.l HWIO_MSS_HI0_CH7_RSLT_CONF_SD3_ADDR A:0x64201a1c
y.create.l HWIO_MSS_HI0_CH0_STATUS_SD0_ADDR A:0x64200d00
y.create.l HWIO_MSS_HI0_CH0_STATUS_SD1_ADDR A:0x64201100
y.create.l HWIO_MSS_HI0_CH0_STATUS_SD2_ADDR A:0x64201500
y.create.l HWIO_MSS_HI0_CH0_STATUS_SD3_ADDR A:0x64201900
y.create.l HWIO_MSS_HI0_CH1_STATUS_SD0_ADDR A:0x64200d04
y.create.l HWIO_MSS_HI0_CH1_STATUS_SD1_ADDR A:0x64201104
y.create.l HWIO_MSS_HI0_CH1_STATUS_SD2_ADDR A:0x64201504
y.create.l HWIO_MSS_HI0_CH1_STATUS_SD3_ADDR A:0x64201904
y.create.l HWIO_MSS_HI0_CH2_STATUS_SD0_ADDR A:0x64200d08
y.create.l HWIO_MSS_HI0_CH2_STATUS_SD1_ADDR A:0x64201108
y.create.l HWIO_MSS_HI0_CH2_STATUS_SD2_ADDR A:0x64201508
y.create.l HWIO_MSS_HI0_CH2_STATUS_SD3_ADDR A:0x64201908
y.create.l HWIO_MSS_HI0_CH3_STATUS_SD0_ADDR A:0x64200d0c
y.create.l HWIO_MSS_HI0_CH3_STATUS_SD1_ADDR A:0x6420110c
y.create.l HWIO_MSS_HI0_CH3_STATUS_SD2_ADDR A:0x6420150c
y.create.l HWIO_MSS_HI0_CH3_STATUS_SD3_ADDR A:0x6420190c
y.create.l HWIO_MSS_HI0_CH4_STATUS_SD0_ADDR A:0x64200d10
y.create.l HWIO_MSS_HI0_CH4_STATUS_SD1_ADDR A:0x64201110
y.create.l HWIO_MSS_HI0_CH4_STATUS_SD2_ADDR A:0x64201510
y.create.l HWIO_MSS_HI0_CH4_STATUS_SD3_ADDR A:0x64201910
y.create.l HWIO_MSS_HI0_CH5_STATUS_SD0_ADDR A:0x64200d14
y.create.l HWIO_MSS_HI0_CH5_STATUS_SD1_ADDR A:0x64201114
y.create.l HWIO_MSS_HI0_CH5_STATUS_SD2_ADDR A:0x64201514
y.create.l HWIO_MSS_HI0_CH5_STATUS_SD3_ADDR A:0x64201914
y.create.l HWIO_MSS_HI0_CH6_STATUS_SD0_ADDR A:0x64200d18
y.create.l HWIO_MSS_HI0_CH6_STATUS_SD1_ADDR A:0x64201118
y.create.l HWIO_MSS_HI0_CH6_STATUS_SD2_ADDR A:0x64201518
y.create.l HWIO_MSS_HI0_CH6_STATUS_SD3_ADDR A:0x64201918
y.create.l HWIO_MSS_HI0_CH7_STATUS_SD0_ADDR A:0x64200d1c
y.create.l HWIO_MSS_HI0_CH7_STATUS_SD1_ADDR A:0x6420111c
y.create.l HWIO_MSS_HI0_CH7_STATUS_SD2_ADDR A:0x6420151c
y.create.l HWIO_MSS_HI0_CH7_STATUS_SD3_ADDR A:0x6420191c
y.create.l HWIO_MSS_HI0_CH0_CONF_ADDR A:0x64200d40
y.create.l HWIO_MSS_HI0_CH1_CONF_ADDR A:0x64200d44
y.create.l HWIO_MSS_HI0_CH2_CONF_ADDR A:0x64200d48
y.create.l HWIO_MSS_HI0_CH3_CONF_ADDR A:0x64200d4c
y.create.l HWIO_MSS_HI0_CH4_CONF_ADDR A:0x64200d50
y.create.l HWIO_MSS_HI0_CH5_CONF_ADDR A:0x64200d54
y.create.l HWIO_MSS_HI0_CH6_CONF_ADDR A:0x64200d58
y.create.l HWIO_MSS_HI0_CH7_CONF_ADDR A:0x64200d5c
y.create.l HWIO_MSS_HI0_CH0_DBG_0_ADDR A:0x64200d80
y.create.l HWIO_MSS_HI0_CH1_DBG_0_ADDR A:0x64200d84
y.create.l HWIO_MSS_HI0_CH2_DBG_0_ADDR A:0x64200d88
y.create.l HWIO_MSS_HI0_CH3_DBG_0_ADDR A:0x64200d8c
y.create.l HWIO_MSS_HI0_CH4_DBG_0_ADDR A:0x64200d90
y.create.l HWIO_MSS_HI0_CH5_DBG_0_ADDR A:0x64200d94
y.create.l HWIO_MSS_HI0_CH6_DBG_0_ADDR A:0x64200d98
y.create.l HWIO_MSS_HI0_CH7_DBG_0_ADDR A:0x64200d9c
y.create.l HWIO_MSS_HI0_CH0_DBG_1_ADDR A:0x64200dc0
y.create.l HWIO_MSS_HI0_CH1_DBG_1_ADDR A:0x64200dc4
y.create.l HWIO_MSS_HI0_CH2_DBG_1_ADDR A:0x64200dc8
y.create.l HWIO_MSS_HI0_CH3_DBG_1_ADDR A:0x64200dcc
y.create.l HWIO_MSS_HI0_CH4_DBG_1_ADDR A:0x64200dd0
y.create.l HWIO_MSS_HI0_CH5_DBG_1_ADDR A:0x64200dd4
y.create.l HWIO_MSS_HI0_CH6_DBG_1_ADDR A:0x64200dd8
y.create.l HWIO_MSS_HI0_CH7_DBG_1_ADDR A:0x64200ddc
y.create.l HWIO_MSS_HI0_CI0_CONF_ADDR A:0x64200e90
y.create.l HWIO_MSS_HI0_CI1_CONF_ADDR A:0x64200e94
y.create.l HWIO_MSS_HI0_CI2_CONF_ADDR A:0x64200e98
y.create.l HWIO_MSS_HI0_CI3_CONF_ADDR A:0x64200e9c
y.create.l HWIO_MSS_HI0_CI4_CONF_ADDR A:0x64200ea0
y.create.l HWIO_MSS_HI0_CI5_CONF_ADDR A:0x64200ea4
y.create.l HWIO_MSS_HI0_CI6_CONF_ADDR A:0x64200ea8
y.create.l HWIO_MSS_HI0_CI7_CONF_ADDR A:0x64200eac
y.create.l HWIO_MSS_HI0_CI0_DBG_ERR_ADDR A:0x64200eb0
y.create.l HWIO_MSS_HI0_CI1_DBG_ERR_ADDR A:0x64200eb4
y.create.l HWIO_MSS_HI0_CI2_DBG_ERR_ADDR A:0x64200eb8
y.create.l HWIO_MSS_HI0_CI3_DBG_ERR_ADDR A:0x64200ebc
y.create.l HWIO_MSS_HI0_CI4_DBG_ERR_ADDR A:0x64200ec0
y.create.l HWIO_MSS_HI0_CI5_DBG_ERR_ADDR A:0x64200ec4
y.create.l HWIO_MSS_HI0_CI6_DBG_ERR_ADDR A:0x64200ec8
y.create.l HWIO_MSS_HI0_CI7_DBG_ERR_ADDR A:0x64200ecc
y.create.l HWIO_MSS_HI0_CRCI_DBG_ADDR A:0x64200ed0
y.create.l HWIO_MSS_HI0_CRCI_STATUS_ADDR A:0x64200ed4
y.create.l HWIO_MSS_HI0_GP_CTL_ADDR A:0x64200ed8
y.create.l HWIO_MSS_HI0_GP_STATUS_ADDR A:0x64200edc
y.create.l HWIO_MSS_HI0_GLBL_DBG_CMD_ENG_ADDR A:0x64200ee0
y.create.l HWIO_MSS_HI0_GLBL_DBG_REQ_ENG_ADDR A:0x64200ee4
y.create.l HWIO_MSS_HI0_GLBL_DBG_XFR_ENG_ADDR A:0x64200ee8
y.create.l HWIO_MSS_HI0_GLBL_DBG_CHAN_BLK_ADDR A:0x64200eec
y.create.l HWIO_MSS_HI0_GLBL_DBG_CHAN_BLK_CLR_ADDR A:0x64200ef0
y.create.l HWIO_MSS_HI0_GLBL_DBG_TEST_SEL_ADDR A:0x64200ef4
y.create.l HWIO_MSS_NAV_AHB_BUP_CONFIG_ADDR A:0x642001c0
y.create.l HWIO_MSS_NAV_AHB_BUP_STATUS_ADDR A:0x642001c4
y.create.l HWIO_MSS_NAV_AHB_BUP_STATUS1_ADDR A:0x642001c8
y.create.l HWIO_MSS_NAV_AHB_BUP_STATUS2_ADDR A:0x642001cc
y.create.l HWIO_MSS_NAV_AHB_BUP_STATUS3_ADDR A:0x642001d0
y.create.l HWIO_MSS_NAV_AHB_BUP_STATUS4_ADDR A:0x642001d4
y.create.l HWIO_MSS_NAV_AHB_BUP_STATUS5_ADDR A:0x642001d8
y.create.l HWIO_MSS_NAV_AHB_BUP_STATUS6_ADDR A:0x642001dc
y.create.l HWIO_MSS_NAV_AHB_BUP_STATUS7_ADDR A:0x642001e0
y.create.l HWIO_MSS_NAV_CLK_ENABLE_ADDR A:0x642f8000
y.create.l HWIO_MSS_NAV_CLK_RESET_ADDR A:0x642f8004
y.create.l HWIO_MSS_NAV_CLK_CTL_ADDR A:0x642f8008
y.create.l HWIO_MSS_NAV_CLK_FRAC31_M_ADDR A:0x642f800c
y.create.l HWIO_MSS_NAV_CLK_FRAC31_NOT_2D_ADDR A:0x642f8010
y.create.l HWIO_MSS_NAV_CLK_FRAC31_NOT_N_MINUS_M_ADDR A:0x642f8014
y.create.l HWIO_MSS_NAV_CLK_FRAC31_UPDATE_ADDR A:0x642f8018
y.create.l HWIO_MSS_NAV_CLK_GDS_ADDR A:0x642f801c
y.create.l HWIO_MSS_NAV_CLK_IPCAT_ADDR A:0x642f8020
y.create.l HWIO_MSS_NAV_CLK_AXI_BRIDGE_STATUS_ADDR A:0x642f8024
y.create.l HWIO_MSS_GNSS_ADC_CMD0_ADDR A:0x642f0000
y.create.l HWIO_MSS_GNSS_ADC_CMD1_ADDR A:0x642f0004
y.create.l HWIO_MSS_GNSS_ADC_CMD2_ADDR A:0x642f0008
y.create.l HWIO_MSS_GNSS_ADC_CMD3_ADDR A:0x642f000c
y.create.l HWIO_MSS_GNSS_ADC_IDDQ_ADDR A:0x642f0010
y.create.l HWIO_MSS_NAV_PLL4_PLLMODE_ADDR A:0x642f8800
y.create.l HWIO_MSS_NAV_PLL4_L_VAL_ADDR A:0x642f8804
y.create.l HWIO_MSS_NAV_PLL4_ALPHA_VAL_L_ADDR A:0x642f8808
y.create.l HWIO_MSS_NAV_PLL4_ALPHA_VAL_H_ADDR A:0x642f880c
y.create.l HWIO_MSS_NAV_PLL4_USER_CTL_ADDR A:0x642f8810
y.create.l HWIO_MSS_NAV_PLL4_USER_CTL_H_ADDR A:0x642f8814
y.create.l HWIO_MSS_NAV_PLL4_CONFIG_CTL_ADDR A:0x642f8818
y.create.l HWIO_MSS_NAV_PLL4_TEST_CTL_ADDR A:0x642f881c
y.create.l HWIO_MSS_NAV_PLL4_STATUS_ADDR A:0x642f8824
y.create.l HWIO_MSS_STMR_STATUS0_RD_ADDR A:0x642000c0
y.create.l HWIO_MSS_STMR_STATUS1_RD_ADDR A:0x642000c4
y.create.l HWIO_MSS_STMR_STATUS2_RD_ADDR A:0x642000c8
y.create.l HWIO_MSS_STMR_STATUS3_RD_ADDR A:0x642000cc
y.create.l HWIO_MSS_STMR_STATUS4_RD_ADDR A:0x642000d0
y.create.l HWIO_MSS_STMR_STATUS5_RD_ADDR A:0x642000d4
y.create.l HWIO_MSS_STMR_STATUS6_RD_ADDR A:0x642000d8
y.create.l HWIO_MSS_STMR_STATUS7_RD_ADDR A:0x642000dc
y.create.l HWIO_MSS_STMR_STATUS8_RD_ADDR A:0x642000e0
y.create.l HWIO_MSS_STMR_STATUS9_RD_ADDR A:0x642000e4
y.create.l HWIO_MSS_STMR_STATUS10_RD_ADDR A:0x642000e8
y.create.l HWIO_MSS_STMR_STATUS11_RD_ADDR A:0x642000ec
y.create.l HWIO_TX_ENABLE_ADDR A:0x64380000
y.create.l HWIO_TX_MEM_ACCESS_CFG_ADDR A:0x64380004
y.create.l HWIO_TX_MEM_PAGE_ADDR A:0x64380008
y.create.l HWIO_TX_AXI_WR_INTF_EVENT_ADDR A:0x6438000c
y.create.l HWIO_TX_STMR_TRIG_FRAC_CNT_0_ADDR A:0x64380010
y.create.l HWIO_TX_FRAME_STB_FRAC_CNT_0_ADDR A:0x64380018
y.create.l HWIO_TX_MISR_CTRL_ADDR A:0x64380020
y.create.l HWIO_TX_MISR_RD_DATA_ADDR A:0x64380024
y.create.l HWIO_TX_MISR_CAP_EN_ADDR A:0x64380028
y.create.l HWIO_HARQ_DONE_STATUS_ADDR A:0x6438002c
y.create.l HWIO_TX_MODE_0_ADDR A:0x64380030
y.create.l HWIO_TX_MODE_COMMON_ADDR A:0x64380038
y.create.l HWIO_TX_ENABLE_GSM_0_ADDR A:0x6438003c
y.create.l HWIO_TX_TDS_CTRL_ADDR A:0x64380044
y.create.l HWIO_TX_MEM_TEST_WR_ADDR_ADDR A:0x64380048
y.create.l HWIO_TX_MEM_TEST_WR_ADDR_STATUS_ADDR A:0x6438004c
y.create.l HWIO_TX_MEM_TEST_RD_ADDR A:0x64380050
y.create.l HWIO_TX_MEM_TEST_RD_ADDR_ADDR A:0x64380054
y.create.l HWIO_TX_MEM_TEST_RD_ADDR_STATUS_ADDR A:0x64380058
y.create.l HWIO_TX_SW_AHB_EVENT_ADDR0_ADDR A:0x64380060
y.create.l HWIO_TX_SW_AHB_EVENT_ADDR1_ADDR A:0x64380064
y.create.l HWIO_TX_SW_AHB_EVENT_ADDR2_ADDR A:0x64380068
y.create.l HWIO_TX_SW_AHB_EVENT_ADDR3_ADDR A:0x6438006c
y.create.l HWIO_TX_SW_AHB_EVENT_ADDR4_ADDR A:0x64380070
y.create.l HWIO_TX_SW_AHB_EVENT_ADDR5_ADDR A:0x64380074
y.create.l HWIO_TX_SW_AHB_EVENT_ADDR6_ADDR A:0x64380078
y.create.l HWIO_TX_SW_AHB_EVENT_ADDR7_ADDR A:0x6438007c
y.create.l HWIO_TX_A2_AHB_EVENT_ADDR_ADDR A:0x64380080
y.create.l HWIO_TX_EVENT_LOG_EN_ADDR A:0x64380084
y.create.l HWIO_TX_EVENT_SEL_0_ADDR A:0x64380088
y.create.l HWIO_TX_EVENT_SEL_1_ADDR A:0x6438008c
y.create.l HWIO_TX_TESTBUS_SEL_ADDR A:0x64380090
y.create.l HWIO_TX_TESTBUS_RD_DATA_ADDR A:0x64380094
y.create.l HWIO_TX_TESTBUS_RD_DATA_MASK_ADDR A:0x64380098
y.create.l HWIO_TX_ERROR_IRQ_EN_ADDR A:0x6438009c
y.create.l HWIO_TX_ERROR_IRQ_CLEAR_ADDR A:0x643800a0
y.create.l HWIO_TX_ERROR_IRQ_STATUS_ADDR A:0x643800a4
y.create.l HWIO_TX_STATUS_RD_ADDR A:0x643800a8
y.create.l HWIO_TX_DEBUG_IRQ_EN_ADDR A:0x643800ac
y.create.l HWIO_TX_DEBUG_IRQ_CLEAR_ADDR A:0x643800b0
y.create.l HWIO_TX_DEBUG_IRQ_STATUS_ADDR A:0x643800b4
y.create.l HWIO_TX_MODE_OFDMA_ADDR A:0x643800bc
y.create.l HWIO_TX_AXI_RD0_INTF_CTL_ADDR A:0x643800c8
y.create.l HWIO_TX_AXI_RD0_INTF_EVENT_ADDR A:0x643800cc
y.create.l HWIO_TX_SW_RESET_ENC_MOD_ADDR A:0x643800e0
y.create.l HWIO_TX_SW_RESET_TXC_TXR_0_ADDR A:0x643800e4
y.create.l HWIO_TX_ENC_CLK_INIT_ADDR A:0x643800ec
y.create.l HWIO_TX_C2K_MODE_ADDR A:0x64381000
y.create.l HWIO_TX_TDS_NEW_FRAME_SW_ADDR A:0x64381064
y.create.l HWIO_TX_UNIFIED_DCH_RACH_ENC_TRIGGER_ADDR A:0x64381068
y.create.l HWIO_TX_TDS_ERUCCH_ENC_TRIGGER_ADDR A:0x6438106c
y.create.l HWIO_TX_1X_ENC_TRIGGER_ADDR A:0x64381070
y.create.l HWIO_TX_DO_ENC_TRIGGER_ADDR A:0x64381074
y.create.l HWIO_TX_DO_CARRIER_CONFIG_ADDR A:0x64381078
y.create.l HWIO_TX_UNIFIED_ENC_NUM_ACTIVE_TRCHS_ADDR A:0x6438107c
y.create.l HWIO_TX_UNIFIED_ENC_ENDIAN_FRMT_CTL_ADDR A:0x64381080
y.create.l HWIO_TX_UNIFIED_ENC_CIPHER_CK0_0_ADDR A:0x64381084
y.create.l HWIO_TX_UNIFIED_ENC_CIPHER_CK0_1_ADDR A:0x64381088
y.create.l HWIO_TX_UNIFIED_ENC_CIPHER_CK0_2_ADDR A:0x6438108c
y.create.l HWIO_TX_UNIFIED_ENC_CIPHER_CK0_3_ADDR A:0x64381090
y.create.l HWIO_TX_UNIFIED_ENC_CIPHER_CK1_0_ADDR A:0x64381094
y.create.l HWIO_TX_UNIFIED_ENC_CIPHER_CK1_1_ADDR A:0x64381098
y.create.l HWIO_TX_UNIFIED_ENC_CIPHER_CK1_2_ADDR A:0x6438109c
y.create.l HWIO_TX_UNIFIED_ENC_CIPHER_CK1_3_ADDR A:0x643810a0
y.create.l HWIO_TX_UNIFIED_ENC_CIPHER_CK2_0_ADDR A:0x643810a4
y.create.l HWIO_TX_UNIFIED_ENC_CIPHER_CK2_1_ADDR A:0x643810a8
y.create.l HWIO_TX_UNIFIED_ENC_CIPHER_CK2_2_ADDR A:0x643810ac
y.create.l HWIO_TX_UNIFIED_ENC_CIPHER_CK2_3_ADDR A:0x643810b0
y.create.l HWIO_TX_UNIFIED_ENC_CIPHER_CK3_0_ADDR A:0x643810b4
y.create.l HWIO_TX_UNIFIED_ENC_CIPHER_CK3_1_ADDR A:0x643810b8
y.create.l HWIO_TX_UNIFIED_ENC_CIPHER_CK3_2_ADDR A:0x643810bc
y.create.l HWIO_TX_UNIFIED_ENC_CIPHER_CK3_3_ADDR A:0x643810c0
y.create.l HWIO_TX_UNIFIED_ENC_CIPHER_CK4_0_ADDR A:0x643810c4
y.create.l HWIO_TX_UNIFIED_ENC_CIPHER_CK4_1_ADDR A:0x643810c8
y.create.l HWIO_TX_UNIFIED_ENC_CIPHER_CK4_2_ADDR A:0x643810cc
y.create.l HWIO_TX_UNIFIED_ENC_CIPHER_CK4_3_ADDR A:0x643810d0
y.create.l HWIO_TX_UNIFIED_ENC_CIPHER_CK5_0_ADDR A:0x643810d4
y.create.l HWIO_TX_UNIFIED_ENC_CIPHER_CK5_1_ADDR A:0x643810d8
y.create.l HWIO_TX_UNIFIED_ENC_CIPHER_CK5_2_ADDR A:0x643810dc
y.create.l HWIO_TX_UNIFIED_ENC_CIPHER_CK5_3_ADDR A:0x643810e0
y.create.l HWIO_TX_UNIFIED_ENC_ERAM_INCRACC_INIT_ADDR A:0x643810e4
y.create.l HWIO_TX_UNIFIED_ENC_FILLER_POLARITY_ADDR A:0x643810e8
y.create.l HWIO_TX_TDS_TTI_ERUCCH_ADDR A:0x643810ec
y.create.l HWIO_TX_UNIFIED_ENC_EUL_CODING_PARAM_BANK0_ADDR A:0x643810f0
y.create.l HWIO_TX_UNIFIED_ENC_EUL_CODING_PARAM_BANK1_ADDR A:0x643810f4
y.create.l HWIO_TX_UNIFIED_ENC_EUL_CODE_SEG_SIZE_BANK0_ADDR A:0x643810f8
y.create.l HWIO_TX_UNIFIED_ENC_EUL_CODE_SEG_SIZE_BANK1_ADDR A:0x643810fc
y.create.l HWIO_TX_UNIFIED_ENC_EUL_TURBO_INTLV_PARAM0_BANK0_ADDR A:0x64381100
y.create.l HWIO_TX_UNIFIED_ENC_EUL_TURBO_INTLV_PARAM0_BANK1_ADDR A:0x64381104
y.create.l HWIO_TX_UNIFIED_ENC_EUL_TURBO_INTLV_PARAM1_BANK0_ADDR A:0x64381108
y.create.l HWIO_TX_UNIFIED_ENC_EUL_TURBO_INTLV_PARAM1_BANK1_ADDR A:0x6438110c
y.create.l HWIO_TX_UNIFIED_ENC_OFFL_ENC_FRAME_ADDR A:0x64381110
y.create.l HWIO_TX_UNIFIED_EUL_ENC_TRIGGER_ADDR A:0x64381114
y.create.l HWIO_TX_UNIFIED_ENC_EUL_ENC_BANK_CFG_ADDR A:0x64381118
y.create.l HWIO_TX_1X_CH1_ENC_CTL_ADDR A:0x6438111c
y.create.l HWIO_TX_1X_CH1_CRC_POLY_ADDR A:0x64381120
y.create.l HWIO_TX_1X_CH2_ENC_CTL_0_ADDR A:0x64381124
y.create.l HWIO_TX_1X_CH2_ENC_CTL_1_ADDR A:0x64381128
y.create.l HWIO_TX_1X_CH2_CRC_POLY_ADDR A:0x6438112c
y.create.l HWIO_TX_1X_CH3_ENC_CTL_0_ADDR A:0x64381130
y.create.l HWIO_TX_1X_CH3_ENC_CTL_1_ADDR A:0x64381134
y.create.l HWIO_TX_1X_CH3_CRC_POLY_ADDR A:0x64381138
y.create.l HWIO_TX_DO_SCRAMB_INIT_0_ADDR A:0x6438113c
y.create.l HWIO_TX_TDS_RM_EINI_ERUCCH_ADDR A:0x64381148
y.create.l HWIO_TX_TDS_RM_EMINUS_ERUCCH_ADDR A:0x6438114c
y.create.l HWIO_TX_TDS_RM_EPLUS_ERUCCH_ADDR A:0x64381150
y.create.l HWIO_TX_TDS_CCTRCH_SI_ADDR A:0x64381154
y.create.l HWIO_TX_TDS_ERUCCH_ADDR_ADDR A:0x64381158
y.create.l HWIO_TX_TDS_CCTRCH_ADDR_ADDR A:0x6438115c
y.create.l HWIO_TX_TDS_SLOT_DATA_NUM0_CCTRCH1_ADDR A:0x64381160
y.create.l HWIO_TX_TDS_SLOT_DATA_NUM1_CCTRCH1_ADDR A:0x64381164
y.create.l HWIO_TX_TDS_SLOT_DATA_NUM2_CCTRCH1_ADDR A:0x64381168
y.create.l HWIO_TX_TDS_SLOT_DATA_NUM0_CCTRCH2_ADDR A:0x6438116c
y.create.l HWIO_TX_TDS_SLOT_DATA_NUM1_CCTRCH2_ADDR A:0x64381170
y.create.l HWIO_TX_TDS_SLOT_DATA_NUM2_CCTRCH2_ADDR A:0x64381174
y.create.l HWIO_TX_UNIFIED_ENC_EUL_RM_SYS_EINI_ADDR A:0x64381178
y.create.l HWIO_TX_UNIFIED_ENC_EUL_RM_SYS_EPLUS_EMINUS_ADDR A:0x6438117c
y.create.l HWIO_TX_UNIFIED_ENC_EUL_RM_P1_EINI_ADDR A:0x64381180
y.create.l HWIO_TX_UNIFIED_ENC_EUL_RM_P1_EPLUS_ADDR A:0x64381184
y.create.l HWIO_TX_UNIFIED_ENC_EUL_RM_P1_EMINUS_ADDR A:0x64381188
y.create.l HWIO_TX_UNIFIED_ENC_EUL_RM_P2_EINI_ADDR A:0x6438118c
y.create.l HWIO_TX_UNIFIED_ENC_EUL_RM_P2_EPLUS_EMINUS_ADDR A:0x64381190
y.create.l HWIO_TX_UNIFIED_ENC_EUL_RM_SYS_NUMBITS_ADDR A:0x64381194
y.create.l HWIO_TX_UNIFIED_ENC_EUL_RM_P1P2_NUMBITS_ADDR A:0x64381198
y.create.l HWIO_TX_TDS_EUL_NUMBITS_ADDR A:0x6438119c
y.create.l HWIO_UMTS_TX_EUL_RM_RAM_BASE_ADDR_ADDR A:0x643811a0
y.create.l HWIO_TX_1X_CH1_PUNCT_PATN_1_ADDR A:0x643811a4
y.create.l HWIO_TX_1X_CH1_PUNCT_PATN_0_ADDR A:0x643811a8
y.create.l HWIO_TX_1X_CH2_PUNCT_PATN_1_ADDR A:0x643811ac
y.create.l HWIO_TX_1X_CH2_PUNCT_PATN_0_ADDR A:0x643811b0
y.create.l HWIO_TX_1X_CH3_PUNCT_PATN_1_ADDR A:0x643811b4
y.create.l HWIO_TX_1X_CH3_PUNCT_PATN_0_ADDR A:0x643811b8
y.create.l HWIO_TX_1X_LPN_BOZO_ADDR A:0x643811bc
y.create.l HWIO_TX_UNIFIED_PN_LD_ADDR A:0x643811c0
y.create.l HWIO_TX_UNIFIED_PN_MASK_LD_ADDR A:0x643811c4
y.create.l HWIO_TX_1X_I_PN_STATE_ADDR A:0x643811c8
y.create.l HWIO_TX_1X_Q_PN_STATE_ADDR A:0x643811cc
y.create.l HWIO_TX_1X_U_PN_MASK_0_ADDR A:0x643811d0
y.create.l HWIO_TX_1X_U_PN_MASK_1_ADDR A:0x643811d4
y.create.l HWIO_TX_1X_U_PN_STATE_0_ADDR A:0x643811d8
y.create.l HWIO_TX_1X_U_PN_STATE_1_ADDR A:0x643811dc
y.create.l HWIO_TX_DO_PN_STATE_0_ADDR A:0x643811e0
y.create.l HWIO_TX_DO_PN_STATE_1_ADDR A:0x643811e4
y.create.l HWIO_TX_DO_I_PN_MASK_0_C0_ADDR A:0x643811e8
y.create.l HWIO_TX_DO_I_PN_MASK_1_C0_ADDR A:0x643811f4
y.create.l HWIO_TX_DO_Q_PN_MASK_0_C0_ADDR A:0x64381200
y.create.l HWIO_TX_DO_Q_PN_MASK_1_C0_ADDR A:0x6438120c
y.create.l HWIO_TX_DO_FOC_PN_CTL_C0_ADDR A:0x64381218
y.create.l HWIO_TX_DO_TRAFFIC_PN_CTL_ADDR A:0x64381224
y.create.l HWIO_TX_UMTS_SCR_CODE_INIT_ADDR A:0x64381228
y.create.l HWIO_TX_TDS_SCR_CODE_INIT_ADDR A:0x64381230
y.create.l HWIO_TX_1X_PICH_PCBIT_DATA_ADDR A:0x64381234
y.create.l HWIO_TX_1X_PICH_PCBIT_MASK_ADDR A:0x64381238
y.create.l HWIO_TX_DO_REV0_RRI_CTL_ADDR A:0x6438123c
y.create.l HWIO_TX_DO_ACK_CTL_C0_ADDR A:0x64381240
y.create.l HWIO_TX_DO_DRC_CTL_C0_ADDR A:0x6438124c
y.create.l HWIO_TX_DO_DSC_CTL_C0_ADDR A:0x64381258
y.create.l HWIO_TX_DO_REVAB_RRI_CTL_C0_ADDR A:0x64381264
y.create.l HWIO_TX_1X_FPC_BIT_ADDR A:0x64381270
y.create.l HWIO_TX_UMTS_PHY_CH_TYPE_ADDR A:0x64381274
y.create.l HWIO_TX_UMTS_RACH_CTL_ADDR A:0x64381278
y.create.l HWIO_TX_UMTS_RACH_OVSF_ADDR A:0x6438127c
y.create.l HWIO_TX_UMTS_CTL_CH_DATA_ADDR A:0x64381280
y.create.l HWIO_TX_UMTS_SPARE_CH_DATA_ADDR A:0x64381284
y.create.l HWIO_TX_UMTS_SPARE_CH_CTL_ADDR A:0x64381288
y.create.l HWIO_TX_UNIFIED_SPARE_DATA_CH_CTL_0_ADDR A:0x6438128c
y.create.l HWIO_TX_UNIFIED_SPARE_DATA_CH_CTL_1_ADDR A:0x64381290
y.create.l HWIO_TX_UNIFIED_SPARE_DATA_CH_FINE_CTL_0_ADDR A:0x64381294
y.create.l HWIO_TX_UNIFIED_SPARE_DATA_CH_FINE_CTL_1_ADDR A:0x64381298
y.create.l HWIO_TX_UMTS_DPDCH_CTL_ADDR A:0x6438129c
y.create.l HWIO_TX_UMTS_HSDPCCH_CTL_ADDR A:0x643812a0
y.create.l HWIO_TX_UMTS_HSDPCCH_DATA_ADDR A:0x643812a4
y.create.l HWIO_TX_UMTS_EUL_NUMBITS_EDPDCH0_ADDR A:0x643812a8
y.create.l HWIO_TX_UMTS_EUL_NUMBITS_EDPDCH1_ADDR A:0x643812ac
y.create.l HWIO_TX_UMTS_EUL_NUMBITS_EDPDCH2_ADDR A:0x643812b0
y.create.l HWIO_TX_UMTS_EUL_NUMBITS_EDPDCH3_ADDR A:0x643812b4
y.create.l HWIO_TX_UMTS_EUL_EDPDCH_CONFIG_ADDR A:0x643812c8
y.create.l HWIO_TX_UMTS_EUL_EDPDCH_CTL0_ADDR A:0x643812cc
y.create.l HWIO_TX_UMTS_EUL_EDPDCH_CTL1_ADDR A:0x643812d0
y.create.l HWIO_TX_UMTS_EUL_EDPDCH_CTL2_ADDR A:0x643812d4
y.create.l HWIO_TX_UMTS_EUL_EDPDCH_CTL3_ADDR A:0x643812d8
y.create.l HWIO_TX_UMTS_EUL_EDPCCH_CTL_ADDR A:0x643812dc
y.create.l HWIO_TX_UMTS_EUL_EDPCCH_DATA_ADDR A:0x643812e0
y.create.l HWIO_TX_TDS_EUCCH_ADDR A:0x643812e4
y.create.l HWIO_TX_TDS_HSSICH0_ADDR A:0x643812e8
y.create.l HWIO_TX_TDS_HSSICH1_ADDR A:0x643812ec
y.create.l HWIO_TX_TDS_HSSICH2_ADDR A:0x643812f0
y.create.l HWIO_TX_TDS_SYNC_UL0_ADDR A:0x643812f4
y.create.l HWIO_TX_TDS_SYNC_UL1_ADDR A:0x643812f8
y.create.l HWIO_TX_TDS_SYNC_UL2_ADDR A:0x643812fc
y.create.l HWIO_TX_TDS_SYNC_UL3_ADDR A:0x64381300
y.create.l HWIO_TX_TDS_MIDAMBLE_SHIFT_ADDR A:0x64381304
y.create.l HWIO_TX_TDS_MIDAMBLE0_ADDR A:0x64381308
y.create.l HWIO_TX_TDS_MIDAMBLE1_ADDR A:0x6438130c
y.create.l HWIO_TX_TDS_MIDAMBLE2_ADDR A:0x64381310
y.create.l HWIO_TX_TDS_MIDAMBLE3_ADDR A:0x64381314
y.create.l HWIO_TX_TDS_SLOT_CTL_PHY_CH0_ADDR A:0x64381318
y.create.l HWIO_TX_TDS_SLOT_CTL_PHY_CH1_ADDR A:0x6438131c
y.create.l HWIO_TX_TDS_SS_PHY_CH0_ADDR A:0x64381320
y.create.l HWIO_TX_TDS_SS_PHY_CH1_ADDR A:0x64381324
y.create.l HWIO_TX_TDS_TFCI_PHY_CH0_ADDR A:0x64381328
y.create.l HWIO_TX_TDS_TFCI_PHY_CH1_ADDR A:0x6438132c
y.create.l HWIO_TX_TDS_TPC_PHY_CH0_ADDR A:0x64381330
y.create.l HWIO_TX_TDS_TPC_PHY_CH1_ADDR A:0x64381334
y.create.l HWIO_TX_UNIFIED_NUM_ZEROS_FLUSH_ADDR A:0x64381338
y.create.l HWIO_TX_UNIFIED_FRAME_OFFSET_ADDR A:0x6438133c
y.create.l HWIO_TX_UNIFIED_FRAME_OFF_LD_ADDR A:0x64381340
y.create.l HWIO_TX_UNIFIED_SAMPLE_CNT_INIT_VAL_ADDR A:0x64381344
y.create.l HWIO_TX_UNIFIED_SAMPLE_CNT_LD_ADDR A:0x64381348
y.create.l HWIO_TX_UNIFIED_SAMPLE_CNT_READ_ADDR A:0x6438134c
y.create.l HWIO_TX_UNIFIED_SAMPLE_CNT_UPDATE_TIME_ADDR A:0x64381350
y.create.l HWIO_TX_UMTS_EUL_TTI_MODE_ADDR A:0x64381354
y.create.l HWIO_TX_UMTS_HSDPCCH_OFFSET_ADDR A:0x64381358
y.create.l HWIO_TX_UNIFIED_BETAP_GAIN_UPDATE_ADDR A:0x6438135c
y.create.l HWIO_TX_UNIFIED_PA_RANGE_UPDATE_ADDR A:0x64381360
y.create.l HWIO_TX_UNIFIED_OFFL_EN_ADDR A:0x64381364
y.create.l HWIO_TX_UNIFIED_DTX_EN_ADDR A:0x64381368
y.create.l HWIO_TX_UNIFIED_ERAM_CTL_ADDR A:0x6438136c
y.create.l HWIO_TX_TDS_EUL_RM_BANK_SEL_ADDR A:0x64381370
y.create.l HWIO_TX_UNIFIED_ENC_STATUS_ADDR A:0x64381374
y.create.l HWIO_TX_TDS_GUARD_PERIOD_ADDR A:0x64381378
y.create.l HWIO_TX_1X_DBR_MASK_READ_ADDR A:0x6438137c
y.create.l HWIO_TX_TDS_NEW_SUBFRAME_FW_ADDR A:0x64381380
y.create.l HWIO_TX_1X_MISC_CTL_ADDR A:0x64381384
y.create.l HWIO_TX_UNIFIED_CARRIER_EN_ADDR A:0x64381388
y.create.l HWIO_TX_DO_GAIN_BANK_ADDR A:0x6438138c
y.create.l HWIO_TX_UNIFIED_GAIN_0_ADDR A:0x64381390
y.create.l HWIO_TX_UNIFIED_GAIN_1_ADDR A:0x64381394
y.create.l HWIO_TX_UNIFIED_GAIN_2_ADDR A:0x64381398
y.create.l HWIO_TX_UNIFIED_GAIN_3_ADDR A:0x6438139c
y.create.l HWIO_TX_UNIFIED_GAIN_4_ADDR A:0x643813a0
y.create.l HWIO_TX_UNIFIED_GAIN_5_ADDR A:0x643813a4
y.create.l HWIO_TX_C2K_BETAP_GAIN_C0_ADDR A:0x643813a8
y.create.l HWIO_TX_UNIFIED_ADVRET_CMD_ADDR A:0x643813b4
y.create.l HWIO_TX_UNIFIED_ADVRET_TYPE_ADDR A:0x643813b8
y.create.l HWIO_TX_1X_MOD_WCOVER_SEL_ADDR A:0x643813bc
y.create.l HWIO_TX_DO_CTL_C0_ADDR A:0x643813c0
y.create.l HWIO_TX_TDS_NUM_DATA_PHY_CH0_ADDR A:0x643813cc
y.create.l HWIO_TX_TDS_NUM_DATA_PHY_CH1_ADDR A:0x643813d0
y.create.l HWIO_TX_TDS_SPR_FACTOR_CTL_ADDR A:0x643813d4
y.create.l HWIO_TX_TDS_EUL_MOD_CTL_ADDR A:0x643813d8
y.create.l HWIO_TX_TDS_SLOT_IDX_ADDR A:0x643813dc
y.create.l HWIO_TX_UMTS_DCH_RACH_LAST_ADDR A:0x643813e0
y.create.l HWIO_TX_UNIFIED_PRED_CLIP_BYPASS_ADDR A:0x643813e4
y.create.l HWIO_TX_UNIFIED_PRED_CLIP_C0_ADDR A:0x643813e8
y.create.l HWIO_TX_UNIFIED_PRED_CLIP_GLOBAL_ADDR A:0x643813f4
y.create.l HWIO_TX_TDS_BBF_WINDOW_ADDR A:0x643813f8
y.create.l HWIO_TX_UNIFIED_PA_RANGE_ADDR A:0x643813fc
y.create.l HWIO_TX_UNIFIED_ROTANGLE_0_ADDR A:0x64381400
y.create.l HWIO_TX_UNIFIED_ROTANGLE_1_ADDR A:0x64381404
y.create.l HWIO_TX_UNIFIED_ROT_FREQ_STEP_C0_ADDR A:0x64381408
y.create.l HWIO_TX_UNIFIED_CRC_BYPASS_ADDR A:0x64381414
y.create.l HWIO_TX_UNIFIED_MEM_PTR_EN_ADDR A:0x64381418
y.create.l HWIO_TX_MEM_ERAM_ADDR_0_ADDR A:0x6438145c
y.create.l HWIO_TX_MEM_ERAM_ADDR_1_ADDR A:0x64381460
y.create.l HWIO_TX_MEM_ERAM_ADDR_2_ADDR A:0x64381464
y.create.l HWIO_TX_MEM_ERAM_ADDR_3_ADDR A:0x64381468
y.create.l HWIO_TX_MEM_ERAM_ADDR_4_ADDR A:0x6438146c
y.create.l HWIO_TX_MEM_ERAM_ADDR_5_ADDR A:0x64381470
y.create.l HWIO_TX_MEM_ERAM_ADDR_6_ADDR A:0x64381474
y.create.l HWIO_TX_MEM_ERAM_ADDR_7_ADDR A:0x64381478
y.create.l HWIO_TX_MEM_ERAM_ADDR_8_ADDR A:0x6438147c
y.create.l HWIO_TX_MEM_ERAM_ADDR_9_ADDR A:0x64381480
y.create.l HWIO_TX_MEM_IRAM_ADDR_0_ADDR A:0x64381490
y.create.l HWIO_TX_MEM_IRAM_ADDR_1_ADDR A:0x64381494
y.create.l HWIO_TX_MEM_IRAM_ADDR_2_ADDR A:0x64381498
y.create.l HWIO_TX_MEM_IRAM_ADDR_3_ADDR A:0x6438149c
y.create.l HWIO_TX_MEM_IRAM_ADDR_4_ADDR A:0x643814a0
y.create.l HWIO_TX_MEM_IRAM_ADDR_5_ADDR A:0x643814a4
y.create.l HWIO_TX_MEM_IRAM_ADDR_6_ADDR A:0x643814a8
y.create.l HWIO_TX_MEM_IRAM_ADDR_7_ADDR A:0x643814ac
y.create.l HWIO_TX_MEM_IRAM_ADDR_8_ADDR A:0x643814b0
y.create.l HWIO_TX_MEM_IRAM_ADDR_9_ADDR A:0x643814b4
y.create.l HWIO_TX_SUMTS_DECIMATE_ADDR A:0x643814c4
y.create.l HWIO_TX_UNIFIED_ENC_TRBLK_PARAM_TRCH0_ADDR A:0x64381800
y.create.l HWIO_TX_UNIFIED_ENC_TRBLK_PARAM_TRCH1_ADDR A:0x64381804
y.create.l HWIO_TX_UNIFIED_ENC_TRBLK_PARAM_TRCH2_ADDR A:0x64381808
y.create.l HWIO_TX_UNIFIED_ENC_TRBLK_PARAM_TRCH3_ADDR A:0x6438180c
y.create.l HWIO_TX_UNIFIED_ENC_TRBLK_PARAM_TRCH4_ADDR A:0x64381810
y.create.l HWIO_TX_UNIFIED_ENC_TRBLK_PARAM_TRCH5_ADDR A:0x64381814
y.create.l HWIO_TX_UNIFIED_ENC_TRBLK_PARAM_TRCH6_ADDR A:0x64381818
y.create.l HWIO_TX_UNIFIED_ENC_TRBLK_PARAM_TRCH7_ADDR A:0x6438181c
y.create.l HWIO_TX_UNIFIED_ENC_ERAMB_ADDR_TRCH0_ADDR A:0x64381820
y.create.l HWIO_TX_UNIFIED_ENC_ERAMB_ADDR_TRCH1_ADDR A:0x64381824
y.create.l HWIO_TX_UNIFIED_ENC_ERAMB_ADDR_TRCH2_ADDR A:0x64381828
y.create.l HWIO_TX_UNIFIED_ENC_ERAMB_ADDR_TRCH3_ADDR A:0x6438182c
y.create.l HWIO_TX_UNIFIED_ENC_ERAMB_ADDR_TRCH4_ADDR A:0x64381830
y.create.l HWIO_TX_UNIFIED_ENC_ERAMB_ADDR_TRCH5_ADDR A:0x64381834
y.create.l HWIO_TX_UNIFIED_ENC_ERAMB_ADDR_TRCH6_ADDR A:0x64381838
y.create.l HWIO_TX_UNIFIED_ENC_ERAMB_ADDR_TRCH7_ADDR A:0x6438183c
y.create.l HWIO_TX_UNIFIED_ENC_CODING_PARAM_TRCH0_ADDR A:0x64381900
y.create.l HWIO_TX_UNIFIED_ENC_CODING_PARAM_TRCH1_ADDR A:0x64381904
y.create.l HWIO_TX_UNIFIED_ENC_CODING_PARAM_TRCH2_ADDR A:0x64381908
y.create.l HWIO_TX_UNIFIED_ENC_CODING_PARAM_TRCH3_ADDR A:0x6438190c
y.create.l HWIO_TX_UNIFIED_ENC_CODING_PARAM_TRCH4_ADDR A:0x64381910
y.create.l HWIO_TX_UNIFIED_ENC_CODING_PARAM_TRCH5_ADDR A:0x64381914
y.create.l HWIO_TX_UNIFIED_ENC_CODING_PARAM_TRCH6_ADDR A:0x64381918
y.create.l HWIO_TX_UNIFIED_ENC_CODING_PARAM_TRCH7_ADDR A:0x6438191c
y.create.l HWIO_TX_UNIFIED_ENC_CODE_SEG_SIZE_TRCH0_ADDR A:0x64381920
y.create.l HWIO_TX_UNIFIED_ENC_CODE_SEG_SIZE_TRCH1_ADDR A:0x64381924
y.create.l HWIO_TX_UNIFIED_ENC_CODE_SEG_SIZE_TRCH2_ADDR A:0x64381928
y.create.l HWIO_TX_UNIFIED_ENC_CODE_SEG_SIZE_TRCH3_ADDR A:0x6438192c
y.create.l HWIO_TX_UNIFIED_ENC_CODE_SEG_SIZE_TRCH4_ADDR A:0x64381930
y.create.l HWIO_TX_UNIFIED_ENC_CODE_SEG_SIZE_TRCH5_ADDR A:0x64381934
y.create.l HWIO_TX_UNIFIED_ENC_CODE_SEG_SIZE_TRCH6_ADDR A:0x64381938
y.create.l HWIO_TX_UNIFIED_ENC_CODE_SEG_SIZE_TRCH7_ADDR A:0x6438193c
y.create.l HWIO_TX_UNIFIED_ENC_RM_EINI_TRCH0_ADDR A:0x64381940
y.create.l HWIO_TX_UNIFIED_ENC_RM_EINI_TRCH1_ADDR A:0x64381944
y.create.l HWIO_TX_UNIFIED_ENC_RM_EINI_TRCH2_ADDR A:0x64381948
y.create.l HWIO_TX_UNIFIED_ENC_RM_EINI_TRCH3_ADDR A:0x6438194c
y.create.l HWIO_TX_UNIFIED_ENC_RM_EINI_TRCH4_ADDR A:0x64381950
y.create.l HWIO_TX_UNIFIED_ENC_RM_EINI_TRCH5_ADDR A:0x64381954
y.create.l HWIO_TX_UNIFIED_ENC_RM_EINI_TRCH6_ADDR A:0x64381958
y.create.l HWIO_TX_UNIFIED_ENC_RM_EINI_TRCH7_ADDR A:0x6438195c
y.create.l HWIO_TX_UNIFIED_ENC_RM_EMINUS_TRCH0_ADDR A:0x64381960
y.create.l HWIO_TX_UNIFIED_ENC_RM_EMINUS_TRCH1_ADDR A:0x64381964
y.create.l HWIO_TX_UNIFIED_ENC_RM_EMINUS_TRCH2_ADDR A:0x64381968
y.create.l HWIO_TX_UNIFIED_ENC_RM_EMINUS_TRCH3_ADDR A:0x6438196c
y.create.l HWIO_TX_UNIFIED_ENC_RM_EMINUS_TRCH4_ADDR A:0x64381970
y.create.l HWIO_TX_UNIFIED_ENC_RM_EMINUS_TRCH5_ADDR A:0x64381974
y.create.l HWIO_TX_UNIFIED_ENC_RM_EMINUS_TRCH6_ADDR A:0x64381978
y.create.l HWIO_TX_UNIFIED_ENC_RM_EMINUS_TRCH7_ADDR A:0x6438197c
y.create.l HWIO_TX_UNIFIED_ENC_RM_EPLUS_TRCH0_ADDR A:0x64381980
y.create.l HWIO_TX_UNIFIED_ENC_RM_EPLUS_TRCH1_ADDR A:0x64381984
y.create.l HWIO_TX_UNIFIED_ENC_RM_EPLUS_TRCH2_ADDR A:0x64381988
y.create.l HWIO_TX_UNIFIED_ENC_RM_EPLUS_TRCH3_ADDR A:0x6438198c
y.create.l HWIO_TX_UNIFIED_ENC_RM_EPLUS_TRCH4_ADDR A:0x64381990
y.create.l HWIO_TX_UNIFIED_ENC_RM_EPLUS_TRCH5_ADDR A:0x64381994
y.create.l HWIO_TX_UNIFIED_ENC_RM_EPLUS_TRCH6_ADDR A:0x64381998
y.create.l HWIO_TX_UNIFIED_ENC_RM_EPLUS_TRCH7_ADDR A:0x6438199c
y.create.l HWIO_TX_UNIFIED_ENC_TURBO_INTLV_PARAM0_TRCH0_ADDR A:0x643819a0
y.create.l HWIO_TX_UNIFIED_ENC_TURBO_INTLV_PARAM0_TRCH1_ADDR A:0x643819a4
y.create.l HWIO_TX_UNIFIED_ENC_TURBO_INTLV_PARAM0_TRCH2_ADDR A:0x643819a8
y.create.l HWIO_TX_UNIFIED_ENC_TURBO_INTLV_PARAM0_TRCH3_ADDR A:0x643819ac
y.create.l HWIO_TX_UNIFIED_ENC_TURBO_INTLV_PARAM0_TRCH4_ADDR A:0x643819b0
y.create.l HWIO_TX_UNIFIED_ENC_TURBO_INTLV_PARAM0_TRCH5_ADDR A:0x643819b4
y.create.l HWIO_TX_UNIFIED_ENC_TURBO_INTLV_PARAM0_TRCH6_ADDR A:0x643819b8
y.create.l HWIO_TX_UNIFIED_ENC_TURBO_INTLV_PARAM0_TRCH7_ADDR A:0x643819bc
y.create.l HWIO_TX_UNIFIED_ENC_TURBO_INTLV_PARAM1_TRCH0_ADDR A:0x643819c0
y.create.l HWIO_TX_UNIFIED_ENC_TURBO_INTLV_PARAM1_TRCH1_ADDR A:0x643819c4
y.create.l HWIO_TX_UNIFIED_ENC_TURBO_INTLV_PARAM1_TRCH2_ADDR A:0x643819c8
y.create.l HWIO_TX_UNIFIED_ENC_TURBO_INTLV_PARAM1_TRCH3_ADDR A:0x643819cc
y.create.l HWIO_TX_UNIFIED_ENC_TURBO_INTLV_PARAM1_TRCH4_ADDR A:0x643819d0
y.create.l HWIO_TX_UNIFIED_ENC_TURBO_INTLV_PARAM1_TRCH5_ADDR A:0x643819d4
y.create.l HWIO_TX_UNIFIED_ENC_TURBO_INTLV_PARAM1_TRCH6_ADDR A:0x643819d8
y.create.l HWIO_TX_UNIFIED_ENC_TURBO_INTLV_PARAM1_TRCH7_ADDR A:0x643819dc
y.create.l HWIO_TX_UNIFIED_ENC_ERAM_DATA_INCRACC_0_ADDR A:0x64381a00
y.create.l HWIO_TX_UNIFIED_ENC_ERAM_DATA_INCRACC_1_ADDR A:0x64381a04
y.create.l HWIO_TX_UNIFIED_ENC_ERAM_DATA_INCRACC_2_ADDR A:0x64381a08
y.create.l HWIO_TX_UNIFIED_ENC_ERAM_DATA_INCRACC_3_ADDR A:0x64381a0c
y.create.l HWIO_TX_UNIFIED_ENC_TRCH_MUX_ORDER_CCTRCH1_ADDR A:0x64381a20
y.create.l HWIO_TX_TDS_TRCH_MUX_ORDER_CCTRCH2_ADDR A:0x64381a40
y.create.l HWIO_TX_TDS_DPCH0_LAST_SLOT0_BANK0_ADDR A:0x64381b00
y.create.l HWIO_TX_TDS_DPCH0_LAST_SLOT1_BANK0_ADDR A:0x64381b04
y.create.l HWIO_TX_TDS_DPCH0_LAST_SLOT2_BANK0_ADDR A:0x64381b08
y.create.l HWIO_TX_TDS_DPCH0_LAST_SLOT3_BANK0_ADDR A:0x64381b0c
y.create.l HWIO_TX_TDS_DPCH0_LAST_SLOT4_BANK0_ADDR A:0x64381b10
y.create.l HWIO_TX_TDS_DPCH0_SLOT0_BANK0_ADDR A:0x64381b40
y.create.l HWIO_TX_TDS_DPCH0_SLOT1_BANK0_ADDR A:0x64381b44
y.create.l HWIO_TX_TDS_DPCH0_SLOT2_BANK0_ADDR A:0x64381b48
y.create.l HWIO_TX_TDS_DPCH0_SLOT3_BANK0_ADDR A:0x64381b4c
y.create.l HWIO_TX_TDS_DPCH0_SLOT4_BANK0_ADDR A:0x64381b50
y.create.l HWIO_TX_TDS_DPCH0_SLOT5_BANK0_ADDR A:0x64381b54
y.create.l HWIO_TX_TDS_DPCH0_SLOT6_BANK0_ADDR A:0x64381b58
y.create.l HWIO_TX_TDS_DPCH0_SLOT7_BANK0_ADDR A:0x64381b5c
y.create.l HWIO_TX_TDS_DPCH0_SLOT8_BANK0_ADDR A:0x64381b60
y.create.l HWIO_TX_TDS_DPCH0_SLOT9_BANK0_ADDR A:0x64381b64
y.create.l HWIO_TX_TDS_DPCH1_LAST_SLOT0_BANK0_ADDR A:0x64381b80
y.create.l HWIO_TX_TDS_DPCH1_LAST_SLOT1_BANK0_ADDR A:0x64381b84
y.create.l HWIO_TX_TDS_DPCH1_LAST_SLOT2_BANK0_ADDR A:0x64381b88
y.create.l HWIO_TX_TDS_DPCH1_LAST_SLOT3_BANK0_ADDR A:0x64381b8c
y.create.l HWIO_TX_TDS_DPCH1_LAST_SLOT4_BANK0_ADDR A:0x64381b90
y.create.l HWIO_TX_TDS_DPCH1_SLOT0_BANK0_ADDR A:0x64381bc0
y.create.l HWIO_TX_TDS_DPCH1_SLOT1_BANK0_ADDR A:0x64381bc4
y.create.l HWIO_TX_TDS_DPCH1_SLOT2_BANK0_ADDR A:0x64381bc8
y.create.l HWIO_TX_TDS_DPCH1_SLOT3_BANK0_ADDR A:0x64381bcc
y.create.l HWIO_TX_TDS_DPCH1_SLOT4_BANK0_ADDR A:0x64381bd0
y.create.l HWIO_TX_TDS_DPCH1_SLOT5_BANK0_ADDR A:0x64381bd4
y.create.l HWIO_TX_TDS_DPCH1_SLOT6_BANK0_ADDR A:0x64381bd8
y.create.l HWIO_TX_TDS_DPCH1_SLOT7_BANK0_ADDR A:0x64381bdc
y.create.l HWIO_TX_TDS_DPCH1_SLOT8_BANK0_ADDR A:0x64381be0
y.create.l HWIO_TX_TDS_DPCH1_SLOT9_BANK0_ADDR A:0x64381be4
y.create.l HWIO_TX_TDS_EPUCH_LAST_BANK0_ADDR A:0x64381c00
y.create.l HWIO_TX_TDS_EPUCH_SLOT0_BANK0_ADDR A:0x64381c20
y.create.l HWIO_TX_TDS_EPUCH_SLOT1_BANK0_ADDR A:0x64381c24
y.create.l HWIO_TX_TDS_EPUCH_SLOT2_BANK0_ADDR A:0x64381c28
y.create.l HWIO_TX_TDS_EPUCH_SLOT3_BANK0_ADDR A:0x64381c2c
y.create.l HWIO_TX_TDS_EPUCH_SLOT4_BANK0_ADDR A:0x64381c30
y.create.l HWIO_TX_TDS_ERUCCH_LAST_BANK0_ADDR A:0x64381c40
y.create.l HWIO_TX_TDS_ERUCCH_SUBFRAME0_BANK0_ADDR A:0x64381c60
y.create.l HWIO_TX_TDS_ERUCCH_SUBFRAME1_BANK0_ADDR A:0x64381c64
y.create.l HWIO_TX_TDS_DPCH0_LAST_SLOT0_BANK1_ADDR A:0x64381ca0
y.create.l HWIO_TX_TDS_DPCH0_LAST_SLOT1_BANK1_ADDR A:0x64381ca4
y.create.l HWIO_TX_TDS_DPCH0_LAST_SLOT2_BANK1_ADDR A:0x64381ca8
y.create.l HWIO_TX_TDS_DPCH0_LAST_SLOT3_BANK1_ADDR A:0x64381cac
y.create.l HWIO_TX_TDS_DPCH0_LAST_SLOT4_BANK1_ADDR A:0x64381cb0
y.create.l HWIO_TX_TDS_DPCH0_SLOT0_BANK1_ADDR A:0x64381cc0
y.create.l HWIO_TX_TDS_DPCH0_SLOT1_BANK1_ADDR A:0x64381cc4
y.create.l HWIO_TX_TDS_DPCH0_SLOT2_BANK1_ADDR A:0x64381cc8
y.create.l HWIO_TX_TDS_DPCH0_SLOT3_BANK1_ADDR A:0x64381ccc
y.create.l HWIO_TX_TDS_DPCH0_SLOT4_BANK1_ADDR A:0x64381cd0
y.create.l HWIO_TX_TDS_DPCH0_SLOT5_BANK1_ADDR A:0x64381cd4
y.create.l HWIO_TX_TDS_DPCH0_SLOT6_BANK1_ADDR A:0x64381cd8
y.create.l HWIO_TX_TDS_DPCH0_SLOT7_BANK1_ADDR A:0x64381cdc
y.create.l HWIO_TX_TDS_DPCH0_SLOT8_BANK1_ADDR A:0x64381ce0
y.create.l HWIO_TX_TDS_DPCH0_SLOT9_BANK1_ADDR A:0x64381ce4
y.create.l HWIO_TX_TDS_DPCH1_LAST_SLOT0_BANK1_ADDR A:0x64381d00
y.create.l HWIO_TX_TDS_DPCH1_LAST_SLOT1_BANK1_ADDR A:0x64381d04
y.create.l HWIO_TX_TDS_DPCH1_LAST_SLOT2_BANK1_ADDR A:0x64381d08
y.create.l HWIO_TX_TDS_DPCH1_LAST_SLOT3_BANK1_ADDR A:0x64381d0c
y.create.l HWIO_TX_TDS_DPCH1_LAST_SLOT4_BANK1_ADDR A:0x64381d10
y.create.l HWIO_TX_TDS_DPCH1_SLOT0_BANK1_ADDR A:0x64381d40
y.create.l HWIO_TX_TDS_DPCH1_SLOT1_BANK1_ADDR A:0x64381d44
y.create.l HWIO_TX_TDS_DPCH1_SLOT2_BANK1_ADDR A:0x64381d48
y.create.l HWIO_TX_TDS_DPCH1_SLOT3_BANK1_ADDR A:0x64381d4c
y.create.l HWIO_TX_TDS_DPCH1_SLOT4_BANK1_ADDR A:0x64381d50
y.create.l HWIO_TX_TDS_DPCH1_SLOT5_BANK1_ADDR A:0x64381d54
y.create.l HWIO_TX_TDS_DPCH1_SLOT6_BANK1_ADDR A:0x64381d58
y.create.l HWIO_TX_TDS_DPCH1_SLOT7_BANK1_ADDR A:0x64381d5c
y.create.l HWIO_TX_TDS_DPCH1_SLOT8_BANK1_ADDR A:0x64381d60
y.create.l HWIO_TX_TDS_DPCH1_SLOT9_BANK1_ADDR A:0x64381d64
y.create.l HWIO_TX_TDS_EPUCH_LAST_BANK1_ADDR A:0x64381d80
y.create.l HWIO_TX_TDS_EPUCH_SLOT0_BANK1_ADDR A:0x64381da0
y.create.l HWIO_TX_TDS_EPUCH_SLOT1_BANK1_ADDR A:0x64381da4
y.create.l HWIO_TX_TDS_EPUCH_SLOT2_BANK1_ADDR A:0x64381da8
y.create.l HWIO_TX_TDS_EPUCH_SLOT3_BANK1_ADDR A:0x64381dac
y.create.l HWIO_TX_TDS_EPUCH_SLOT4_BANK1_ADDR A:0x64381db0
y.create.l HWIO_TX_TDS_ERUCCH_LAST_BANK1_ADDR A:0x64381dc0
y.create.l HWIO_TX_TDS_ERUCCH_SUBFRAME0_BANK1_ADDR A:0x64381de0
y.create.l HWIO_TX_TDS_ERUCCH_SUBFRAME1_BANK1_ADDR A:0x64381de4
y.create.l HWIO_TX_DO_GAIN_0_1_C0_BANK0_ADDR A:0x64381e00
y.create.l HWIO_TX_DO_GAIN_2_3_C0_BANK0_ADDR A:0x64381e0c
y.create.l HWIO_TX_DO_GAIN_4_5_C0_BANK0_ADDR A:0x64381e18
y.create.l HWIO_TX_DO_GAIN_6_7_C0_BANK0_ADDR A:0x64381e24
y.create.l HWIO_TX_DO_GAIN_8_9_C0_BANK0_ADDR A:0x64381e30
y.create.l HWIO_TX_DO_GAIN_0_1_C0_BANK1_ADDR A:0x64381f00
y.create.l HWIO_TX_DO_GAIN_2_3_C0_BANK1_ADDR A:0x64381f0c
y.create.l HWIO_TX_DO_GAIN_4_5_C0_BANK1_ADDR A:0x64381f18
y.create.l HWIO_TX_DO_GAIN_6_7_C0_BANK1_ADDR A:0x64381f24
y.create.l HWIO_TX_DO_GAIN_8_9_C0_BANK1_ADDR A:0x64381f30
y.create.l HWIO_TX_MEM_START_ADDR A:0x64382000
y.create.l HWIO_TX_RDR0_CFG0_ADDR A:0x64383000
y.create.l HWIO_TX_RDR1_CFG0_ADDR A:0x64383008
y.create.l HWIO_TX_RDR0_CFG1_ADDR A:0x64383004
y.create.l HWIO_TX_RDR1_CFG1_ADDR A:0x6438300c
y.create.l HWIO_TX_RDR0_XFER_CTL_ADDR A:0x64383010
y.create.l HWIO_TX_RDR1_XFER_CTL_ADDR A:0x64383014
y.create.l HWIO_TX_WRTR_CFG0_ADDR A:0x64383018
y.create.l HWIO_TX_WRTR_CFG1_ADDR A:0x6438301c
y.create.l HWIO_TX_WRTR_XFER_CTL_ADDR A:0x64383020
y.create.l HWIO_TX_BRDG_CTL_ADDR A:0x64383024
y.create.l HWIO_TX_BRDG_STATUS_ADDR A:0x64383028
y.create.l HWIO_TX_BRDG_CLEAR_ADDR A:0x6438302c
y.create.l HWIO_TX_BRDG_ARB_PRI_ADDR A:0x64383030
y.create.l HWIO_TX_RDR0_VBUF_ADDR_ADDR A:0x64383034
y.create.l HWIO_TX_RDR1_VBUF_ADDR_ADDR A:0x64383038
y.create.l HWIO_TX_WRTR_VBUF_ADDR_ADDR A:0x6438303c
y.create.l HWIO_TX_BRDG_AXI_PRI_ADDR A:0x64383040
y.create.l HWIO_TXR_IQ_DAC_A0_ADDR A:0x64385000
y.create.l HWIO_TXR_STR_CTRL_A0_ADDR A:0x64385008
y.create.l HWIO_TXR_PDA_CTRL_A0_ADDR A:0x6438500c
y.create.l HWIO_TXR_PDA_WD_UPDATE_CTRL_A0_ADDR A:0x64385010
y.create.l HWIO_TXR_PDA_CTRL_WD_OFFSET_A0_ADDR A:0x64385014
y.create.l HWIO_TXR_PDA_OFFSET_CMD_A0_ADDR A:0x64385018
y.create.l HWIO_TXR_PPDSM_CTL_A0_ADDR A:0x6438501c
y.create.l HWIO_TXR_PPDSM_OVERRIDE_VAL_A0_ADDR A:0x64385020
y.create.l HWIO_TXR_PPDSM_OVERRIDE_REP_A0_ADDR A:0x64385024
y.create.l HWIO_TXR_FIFO_PTR_DIFF_A_A0_ADDR A:0x64385028
y.create.l HWIO_TXR_FIFO_PTR_DIFF_B_A0_ADDR A:0x6438502c
y.create.l HWIO_TXR_FIFO_STATUS_A_A0_ADDR A:0x64385030
y.create.l HWIO_TXR_FIFO_STATUS_B_A0_ADDR A:0x64385034
y.create.l HWIO_TXR_FIFO_CMD_A0_ADDR A:0x64385038
y.create.l HWIO_TXR_FIFO_CTRL_A0_ADDR A:0x6438503c
y.create.l HWIO_TXR_STREAM_IF_CTRL_A0_ADDR A:0x64385040
y.create.l HWIO_TXR_FMT_CONV_CTL_A0_ADDR A:0x64385050
y.create.l HWIO_TXR_TEST_BUS_IN_IQ_SWAP_A0_ADDR A:0x64385054
y.create.l HWIO_TXR_TEST_BUS_OUT_IQ_SWAP_A0_ADDR A:0x64385058
y.create.l HWIO_TXR_IQ_DAC_CURRENT_A0_ADDR A:0x6438505c
y.create.l HWIO_TXR_STR_CTRL_CURRENT_A0_ADDR A:0x64385060
y.create.l HWIO_TXR_PDA_CTRL_CURRENT_A0_ADDR A:0x64385064
y.create.l HWIO_TXR_PDA_WD_UPDATE_CTRL_CURRENT_A0_ADDR A:0x64385068
y.create.l HWIO_TXR_PDA_CTRL_WD_OFFSET_CURRENT_A0_ADDR A:0x6438506c
y.create.l HWIO_TXR_PDA_OFFSET_CMD_CURRENT_A0_ADDR A:0x64385070
y.create.l HWIO_TXR_PPDSM_CTL_CURRENT_A0_ADDR A:0x64385074
y.create.l HWIO_TXR_PPDSM_OVERRIDE_VAL_CURRENT_A0_ADDR A:0x64385078
y.create.l HWIO_TXR_PPDSM_OVERRIDE_REP_CURRENT_A0_ADDR A:0x6438507c
y.create.l HWIO_TXR_STREAM_IF_CTRL_CURRENT_A0_ADDR A:0x64385080
y.create.l HWIO_TXR_FMT_CONV_CTL_CURRENT_A0_ADDR A:0x64385084
y.create.l HWIO_TXC_TECH_SEL_A0_ADDR A:0x64384000
y.create.l HWIO_TXC_DP_CFG_A0_ADDR A:0x64384004
y.create.l HWIO_TXC_DP_CFG_2_A0_ADDR A:0x64384008
y.create.l HWIO_TXC_DP_ENV_SCALE_VAL_A0_ADDR A:0x64384010
y.create.l HWIO_TXC_DP_ENV_SCALE_VAL_SET2_A0_ADDR A:0x64384014
y.create.l HWIO_TXC_DP_ENV_SCALE_VAL_IMM_A0_ADDR A:0x64384018
y.create.l HWIO_TXC_DP_RAMP_ARM_A0_ADDR A:0x64384024
y.create.l HWIO_TXC_DP_RAMP_START_TIME_A0_ADDR A:0x64384028
y.create.l HWIO_TXC_DP_RAMP_SLOT_A_CFG_A0_ADDR A:0x64384038
y.create.l HWIO_TXC_DP_RAMP_SLOT_B_CFG_A0_ADDR A:0x6438403c
y.create.l HWIO_TXC_DP_RAMP_GAP_A0_ADDR A:0x64384040
y.create.l HWIO_TXC_DP_RAMP_SLOT_A_CFG_ACT_A0_ADDR A:0x64384044
y.create.l HWIO_TXC_DP_RAMP_SLOT_B_CFG_ACT_A0_ADDR A:0x64384048
y.create.l HWIO_TXC_DP_RAMP_GAP_ACT_A0_ADDR A:0x6438404c
y.create.l HWIO_TXC_DP_PHASE_OVR_VAL_A0_ADDR A:0x64384080
y.create.l HWIO_TXC_PP_PHASE_OVR_VAL_A0_ADDR A:0x64384084
y.create.l HWIO_TXC_DP_ENV_OVR_VAL_A0_ADDR A:0x64384088
y.create.l HWIO_TXC_EP_ENV_OVR_VAL_A0_ADDR A:0x6438408c
y.create.l HWIO_TXC_EP_ENV_OVR_VAL_SET2_A0_ADDR A:0x64384090
y.create.l HWIO_TXC_DP_ROT_PHASE_INC_A0_ADDR A:0x643840a0
y.create.l HWIO_TXC_DP_ROT_PHASE_INC_SET2_A0_ADDR A:0x643840a4
y.create.l HWIO_TXC_DP_ROT_PHASE_INIT_A0_ADDR A:0x643840a8
y.create.l HWIO_TXC_DP_ROT_PHASE_INIT_SET2_A0_ADDR A:0x643840ac
y.create.l HWIO_TXC_DP_ROT_PHASE_SHIFT_A0_ADDR A:0x643840b0
y.create.l HWIO_TXC_DP_ROT_PHASE_SHIFT_SET2_A0_ADDR A:0x643840b4
y.create.l HWIO_TXC_DP_IQ_GAIN_A0_ADDR A:0x643840b8
y.create.l HWIO_TXC_DP_IQ_GAIN_SET2_A0_ADDR A:0x643840bc
y.create.l HWIO_TXC_DP_IQMC_A0_ADDR A:0x643840d0
y.create.l HWIO_TXC_DP_IQMC_SET2_A0_ADDR A:0x643840d4
y.create.l HWIO_TXC_DP_PEQ1_A0_ADDR A:0x643840d8
y.create.l HWIO_TXC_DP_PEQ1_SET2_A0_ADDR A:0x643840dc
y.create.l HWIO_TXC_DP_PEQ2_A0_ADDR A:0x643840f0
y.create.l HWIO_TXC_DP_PEQ2_SET2_A0_ADDR A:0x643840f4
y.create.l HWIO_TXC_DP_DCOC_A0_ADDR A:0x643840f8
y.create.l HWIO_TXC_DP_DCOC_SET2_A0_ADDR A:0x643840fc
y.create.l HWIO_TXC_DM1_CFG_A0_ADDR A:0x64384100
y.create.l HWIO_TXC_DP_IQ_GAIN_IMM_A0_ADDR A:0x64384104
y.create.l HWIO_TXC_DP_IQMC_IMM_A0_ADDR A:0x64384108
y.create.l HWIO_TXC_DP_DCOC_IMM_A0_ADDR A:0x6438410c
y.create.l HWIO_TXC_DP_PEQ1_Q_A0_ADDR A:0x64384110
y.create.l HWIO_TXC_DP_PEQ1_Q_SET2_A0_ADDR A:0x64384114
y.create.l HWIO_TXC_EP_GAIN_A0_ADDR A:0x64384160
y.create.l HWIO_TXC_EP_GAIN_SET2_A0_ADDR A:0x64384164
y.create.l HWIO_TXC_EP_PEQ1_A0_ADDR A:0x64384168
y.create.l HWIO_TXC_EP_PEQ1_SET2_A0_ADDR A:0x6438416c
y.create.l HWIO_TXC_EP_DCOC_A0_ADDR A:0x64384170
y.create.l HWIO_TXC_EP_DCOC_SET2_A0_ADDR A:0x64384174
y.create.l HWIO_TXC_EP_DM2_FINE_TAU_A0_ADDR A:0x64384178
y.create.l HWIO_TXC_EP_DM3_FRAC_TAU_A0_ADDR A:0x6438417c
y.create.l HWIO_TXC_PP_GAIN_A0_ADDR A:0x64384180
y.create.l HWIO_TXC_PP_SPILL_A0_ADDR A:0x64384190
y.create.l HWIO_TXC_EP_PEQ2_A0_ADDR A:0x64384198
y.create.l HWIO_TXC_TIMESTAMP_T1_A0_ADDR A:0x643841a0
y.create.l HWIO_TXC_TIMESTAMP_T2_A0_ADDR A:0x643841a8
y.create.l HWIO_TXC_TIMESTAMP_REUSE_A0_ADDR A:0x643841b0
y.create.l HWIO_TXC_SAMPLE_COUNT_A0_ADDR A:0x643841b4
y.create.l HWIO_TXC_SAMPLE_COUNT_CTL_A0_ADDR A:0x643841b8
y.create.l HWIO_TXC_REF_ARM_A0_ADDR A:0x643841c0
y.create.l HWIO_TXC_REF_DWN_FACTOR_A0_ADDR A:0x643841c4
y.create.l HWIO_TXC_REF_NUM_SAMPLES_A0_ADDR A:0x643841c8
y.create.l HWIO_TXC_REF_START_TIME_A0_ADDR A:0x643841cc
y.create.l HWIO_TXC_REF_STATUS_A0_ADDR A:0x643841d0
y.create.l HWIO_TXC_REF_PEAK_POWER_A0_ADDR A:0x643841d4
y.create.l HWIO_TXC_REF_RMS_POWER_M_A0_ADDR A:0x643841d8
y.create.l HWIO_TXC_REF_RMS_POWER_L_A0_ADDR A:0x643841dc
y.create.l HWIO_TXC_REF_MODE_A0_ADDR A:0x643841e0
y.create.l HWIO_TXC_REF_I_GAIN_VAL_A0_ADDR A:0x643841e4
y.create.l HWIO_TXC_REF_Q_GAIN_VAL_A0_ADDR A:0x643841e8
y.create.l HWIO_TXC_REF_POWERCALC_OR_LOG_A0_ADDR A:0x643841ec
y.create.l HWIO_TXC_TESTBUS_SELECT_A0_ADDR A:0x643841f0
y.create.l HWIO_TXC_TEST_BUS_IN_IQ_SWAP_A0_ADDR A:0x643841f4
y.create.l HWIO_TXC_TEST_BUS_OUT_IQ_SWAP_A0_ADDR A:0x643841f8
y.create.l HWIO_TXC_AMAM_PENDING_A0_ADDR A:0x64384220
y.create.l HWIO_TXC_AMPM_PENDING_A0_ADDR A:0x64384224
y.create.l HWIO_TXC_AMAM_PENDING_SET2_A0_ADDR A:0x64384230
y.create.l HWIO_TXC_AMPM_PENDING_SET2_A0_ADDR A:0x64384234
y.create.l HWIO_TXC_AMAM_ACTIVE_A0_ADDR A:0x64384240
y.create.l HWIO_TXC_AMPM_ACTIVE_A0_ADDR A:0x64384244
y.create.l HWIO_TXC_RAMP_ACTIVE_A0_ADDR A:0x6438424c
y.create.l HWIO_TXC_REF_POWER_SUM_I_A0_ADDR A:0x643842e0
y.create.l HWIO_TXC_REF_POWER_SUM_Q_A0_ADDR A:0x643842e4
y.create.l HWIO_TXC_REF_POWER_SUM_IQ_M_A0_ADDR A:0x643842e8
y.create.l HWIO_TXC_REF_POWER_SUM_IQ_L_A0_ADDR A:0x643842ec
y.create.l HWIO_TXC_REF_POWER_SUM_QQ_M_A0_ADDR A:0x643842f0
y.create.l HWIO_TXC_REF_POWER_SUM_QQ_L_A0_ADDR A:0x643842f4
y.create.l HWIO_TXC_DP_CFG_LATCHED_A0_ADDR A:0x64384300
y.create.l HWIO_TXC_DP_ENV_SCALE_VAL_LATCHED_A0_ADDR A:0x64384304
y.create.l HWIO_TXC_DP_PHASE_OVR_VAL_LATCHED_A0_ADDR A:0x64384308
y.create.l HWIO_TXC_PP_PHASE_OVR_VAL_LATCHED_A0_ADDR A:0x6438430c
y.create.l HWIO_TXC_DP_ENV_OVR_VAL_LATCHED_A0_ADDR A:0x64384310
y.create.l HWIO_TXC_EP_ENV_OVR_VAL_LATCHED_A0_ADDR A:0x64384314
y.create.l HWIO_TXC_DP_ROT_PHASE_INC_LATCHED_A0_ADDR A:0x64384318
y.create.l HWIO_TXC_DP_ROT_PHASE_INIT_LATCHED_A0_ADDR A:0x6438431c
y.create.l HWIO_TXC_DP_ROT_PHASE_SHIFT_LATCHED_A0_ADDR A:0x64384320
y.create.l HWIO_TXC_DP_IQ_GAIN_LATCHED_A0_ADDR A:0x64384324
y.create.l HWIO_TXC_DP_IQMC_LATCHED_A0_ADDR A:0x64384328
y.create.l HWIO_TXC_DP_PEQ1_LATCHED_A0_ADDR A:0x6438432c
y.create.l HWIO_TXC_DP_PEQ2_LATCHED_A0_ADDR A:0x64384330
y.create.l HWIO_TXC_DP_DCOC_LATCHED_A0_ADDR A:0x64384334
y.create.l HWIO_TXC_DM1_CFG_LATCHED_A0_ADDR A:0x64384338
y.create.l HWIO_TXC_EP_GAIN_LATCHED_A0_ADDR A:0x6438433c
y.create.l HWIO_TXC_EP_PEQ1_LATCHED_A0_ADDR A:0x64384340
y.create.l HWIO_TXC_EP_DCOC_LATCHED_A0_ADDR A:0x64384344
y.create.l HWIO_TXC_EP_DM2_FINE_TAU_LATCHED_A0_ADDR A:0x64384348
y.create.l HWIO_TXC_EP_DM3_FRAC_TAU_LATCHED_A0_ADDR A:0x6438434c
y.create.l HWIO_TXC_PP_GAIN_LATCHED_A0_ADDR A:0x64384350
y.create.l HWIO_TXC_PP_SPILL_LATCHED_A0_ADDR A:0x64384354
y.create.l HWIO_TXC_EP_PEQ2_LATCHED_A0_ADDR A:0x64384358
y.create.l HWIO_TXC_DP_CFG_2_LATCHED_A0_ADDR A:0x6438435c
y.create.l HWIO_TXC_DP_PEQ1_Q_LATCHED_A0_ADDR A:0x64384360
y.create.l HWIO_TXC_MEM_BANK0_ADDR0_ADDR A:0x64388000
y.create.l HWIO_TXC_MEM_BANK0_ADDR1_ADDR A:0x64388004
y.create.l HWIO_TXC_MEM_BANK0_ADDR2_ADDR A:0x64388008
y.create.l HWIO_TXC_MEM_BANK0_ADDR3_ADDR A:0x6438800c
y.create.l HWIO_TXC_MEM_BANK1_ADDR0_ADDR A:0x64388400
y.create.l HWIO_TXC_MEM_BANK1_ADDR1_ADDR A:0x64388404
y.create.l HWIO_TXC_MEM_BANK1_ADDR2_ADDR A:0x64388408
y.create.l HWIO_TXC_MEM_BANK1_ADDR3_ADDR A:0x6438840c
y.create.l HWIO_TXC_MEM_BANK2_ADDR0_ADDR A:0x64388800
y.create.l HWIO_TXC_MEM_BANK2_ADDR1_ADDR A:0x64388804
y.create.l HWIO_TXC_MEM_BANK2_ADDR2_ADDR A:0x64388808
y.create.l HWIO_TXC_MEM_BANK2_ADDR3_ADDR A:0x6438880c
y.create.l HWIO_TXC_MEM_BANK3_ADDR0_ADDR A:0x64388c00
y.create.l HWIO_TXC_MEM_BANK3_ADDR1_ADDR A:0x64388c04
y.create.l HWIO_TXC_MEM_BANK3_ADDR2_ADDR A:0x64388c08
y.create.l HWIO_TXC_MEM_BANK3_ADDR3_ADDR A:0x64388c0c
y.create.l HWIO_TXC_MEM_BANK4_ADDR0_ADDR A:0x64389000
y.create.l HWIO_TXC_MEM_BANK4_ADDR1_ADDR A:0x64389004
y.create.l HWIO_TXC_MEM_BANK4_ADDR2_ADDR A:0x64389008
y.create.l HWIO_TXC_MEM_BANK4_ADDR3_ADDR A:0x6438900c
y.create.l HWIO_TXC_MEM_BANK5_ADDR0_ADDR A:0x64389400
y.create.l HWIO_TXC_MEM_BANK5_ADDR1_ADDR A:0x64389404
y.create.l HWIO_TXC_MEM_BANK5_ADDR2_ADDR A:0x64389408
y.create.l HWIO_TXC_MEM_BANK5_ADDR3_ADDR A:0x6438940c
y.create.l HWIO_O_TX_TEST_MODE_ADDR A:0x6438a000
y.create.l HWIO_O_TX_CLK_CTL_ADDR A:0x6438a004
y.create.l HWIO_O_TX_SW_CLK_CTL_ADDR A:0x6438a008
y.create.l HWIO_O_TX_CLK_STATUS_REG_ADDR A:0x6438a00c
y.create.l HWIO_O_TX_ENCODER_STATUS_ADDR A:0x6438a010
y.create.l HWIO_O_TX_HW_IDLE_ADDR A:0x6438a014
y.create.l HWIO_O_TX_BUS_TIMEOUT_ADDR A:0x6438a018
y.create.l HWIO_O_TX_WMORE_INT_STATUS_ADDR A:0x6438a01c
y.create.l HWIO_O_TX_WMORE_INT_CLEAR_ADDR A:0x6438a020
y.create.l HWIO_O_TX_WMORE_TX_PWRDWN_ADDR A:0x6438a024
y.create.l HWIO_O_TX_L0_DEC_ACK_BITS_ADDR A:0x6438a028
y.create.l HWIO_O_TX_L1_DEC_ACK_BITS_ADDR A:0x6438a02c
y.create.l HWIO_O_TX_WMORE_CLIP_THR1_ADDR A:0x6438a030
y.create.l HWIO_O_TX_WMORE_CLIP_THR2_ADDR A:0x6438a034
y.create.l HWIO_O_TX_WMORE_TS2_ADDR A:0x6438a038
y.create.l HWIO_O_TX_WMORE_TS1_ADDR A:0x6438a03c
y.create.l HWIO_O_TX_WMORE_CLIP_ENABLE_ADDR A:0x6438a040
y.create.l HWIO_O_TX_WMORE_NOTCH_ENABLE_ADDR A:0x6438a044
y.create.l HWIO_O_TX_WMORE_NOTCH_ALPHA_I_ADDR A:0x6438a048
y.create.l HWIO_O_TX_WMORE_NOTCH_ALPHA_Q_ADDR A:0x6438a04c
y.create.l HWIO_O_TX_WMORE_NOTCH_BETA_ADDR A:0x6438a050
y.create.l HWIO_O_TX_WMORE_NOTCH_TS1_ADDR A:0x6438a054
y.create.l HWIO_O_TX_WMORE_IFFT_SIZE_ADDR A:0x6438a058
y.create.l HWIO_O_TX_WMORE_STATUS_WORD0_ADDR A:0x6438a200
y.create.l HWIO_TX_LTE_WMORE_WORD0_ADDR A:0x6438a300
y.create.l HWIO_TX_LTE_WMORE_WORD1_ADDR A:0x6438a304
y.create.l HWIO_TX_LTE_WMORE_WORD2_ADDR A:0x6438a308
y.create.l HWIO_TX_LTE_WMORE_WORD3_ADDR A:0x6438a30c
y.create.l HWIO_TX_LTE_WMORE_WORD4_ADDR A:0x6438a310
y.create.l HWIO_TX_LTE_WMORE_WORD5_ADDR A:0x6438a314
y.create.l HWIO_TX_LTE_WMORE_WORD6_ADDR A:0x6438a318
y.create.l HWIO_TX_LTE_WMORE_WORD7_ADDR A:0x6438a31c
y.create.l HWIO_TX_LTE_WMORE_UPPTS_WORD0_ADDR A:0x6438a400
y.create.l HWIO_TX_LTE_WMORE_UPPTS_WORD1_ADDR A:0x6438a404
y.create.l HWIO_TX_LTE_WMORE_UPPTS_WORD2_ADDR A:0x6438a408
y.create.l HWIO_TX_LTE_WMORE_UPPTS_WORD3_ADDR A:0x6438a40c
y.create.l HWIO_TX_LTE_WMORE_PRACH_WORD0_ADDR A:0x6438a500
y.create.l HWIO_TX_LTE_WMORE_PRACH_WORD1_ADDR A:0x6438a504
y.create.l HWIO_TX_LTE_WMORE_PRACH_WORD2_ADDR A:0x6438a508
y.create.l HWIO_O_TX_ENC_STATUS_WORD0_ADDR A:0x6438a600
y.create.l HWIO_TX_LTE_PUSCH_ENC_WORD0_ADDR A:0x6438a700
y.create.l HWIO_TX_LTE_PUSCH_ENC_WORD1_ADDR A:0x6438a704
y.create.l HWIO_TX_LTE_PUSCH_ENC_WORD2_ADDR A:0x6438a708
y.create.l HWIO_TX_LTE_PUSCH_ENC_WORD3_ADDR A:0x6438a70c
y.create.l HWIO_TX_LTE_PUSCH_ENC_WORD4_ADDR A:0x6438a710
y.create.l HWIO_O_TX_MOD_STATUS_WORD0_ADDR A:0x6438a800
y.create.l HWIO_TX_LTE_PUSCH_MOD_WORD0_ADDR A:0x6438a900
y.create.l HWIO_TX_LTE_PUSCH_MOD_WORD1_ADDR A:0x6438a904
y.create.l HWIO_TX_LTE_PUSCH_MOD_WORD2_ADDR A:0x6438a908
y.create.l HWIO_TX_LTE_PUSCH_MOD_WORD3_ADDR A:0x6438a90c
y.create.l HWIO_TX_LTE_PUSCH_MOD_WORD4_ADDR A:0x6438a910
y.create.l HWIO_TX_LTE_PUSCH_MOD_WORD5_ADDR A:0x6438a914
y.create.l HWIO_TX_LTE_PUSCH_MOD_WORD6_ADDR A:0x6438a918
y.create.l HWIO_TX_LTE_PUSCH_MOD_WORD7_ADDR A:0x6438a91c
y.create.l HWIO_TX_LTE_PUSCH_MOD_WORD8_ADDR A:0x6438a920
y.create.l HWIO_TX_LTE_PUSCH_MOD_WORD9_ADDR A:0x6438a924
y.create.l HWIO_TX_LTE_PUSCH_MOD_WORD10_ADDR A:0x6438a928
y.create.l HWIO_TX_LTE_PUSCH_MOD_WORD11_ADDR A:0x6438a92c
y.create.l HWIO_TX_LTE_PUSCH_MOD_WORD12_ADDR A:0x6438a930
y.create.l HWIO_TX_LTE_PUSCH_MOD_WORD13_ADDR A:0x6438a934
y.create.l HWIO_TX_LTE_PUSCH_MOD_WORD14_ADDR A:0x6438a938
y.create.l HWIO_TX_LTE_PUSCH_MOD_WORD15_ADDR A:0x6438a93c
y.create.l HWIO_TX_LTE_PUSCH_MOD_WORD16_ADDR A:0x6438a940
y.create.l HWIO_TX_LTE_PUSCH_MOD_WORD17_ADDR A:0x6438a944
y.create.l HWIO_TX_LTE_PUSCH_MOD_WORD18_ADDR A:0x6438a948
y.create.l HWIO_TX_LTE_PUSCH_MOD_WORD19_ADDR A:0x6438a94c
y.create.l HWIO_TX_LTE_PUSCH_MOD_WORD20_ADDR A:0x6438a950
y.create.l HWIO_TX_LTE_PUSCH_MOD_WORD21_ADDR A:0x6438a954
y.create.l HWIO_TX_LTE_PUCCH_MOD_WORD0_ADDR A:0x6438aa00
y.create.l HWIO_TX_LTE_PUCCH_MOD_WORD1_ADDR A:0x6438aa04
y.create.l HWIO_TX_LTE_PUCCH_MOD_WORD2_ADDR A:0x6438aa08
y.create.l HWIO_TX_LTE_PUCCH_MOD_WORD3_ADDR A:0x6438aa0c
y.create.l HWIO_TX_LTE_PUCCH_MOD_WORD4_ADDR A:0x6438aa10
y.create.l HWIO_TX_LTE_PUCCH_MOD_WORD5_ADDR A:0x6438aa14
y.create.l HWIO_TX_LTE_PUCCH_MOD_WORD6_ADDR A:0x6438aa18
y.create.l HWIO_TX_LTE_PUCCH_MOD_WORD7_ADDR A:0x6438aa1c
y.create.l HWIO_TX_LTE_PUCCH_MOD_WORD8_ADDR A:0x6438aa20
y.create.l HWIO_TX_LTE_PUCCH_MOD_WORD9_ADDR A:0x6438aa24
y.create.l HWIO_TX_LTE_PUCCH_MOD_WORD10_ADDR A:0x6438aa28
y.create.l HWIO_TX_LTE_PUCCH_MOD_WORD11_ADDR A:0x6438aa2c
y.create.l HWIO_TX_LTE_PUCCH_MOD_WORD12_ADDR A:0x6438aa30
y.create.l HWIO_TX_LTE_PUCCH_MOD_WORD13_ADDR A:0x6438aa34
y.create.l HWIO_TX_LTE_PRACH_MOD_WORD0_ADDR A:0x6438ab00
y.create.l HWIO_TX_LTE_PRACH_MOD_WORD1_ADDR A:0x6438ab04
y.create.l HWIO_TX_LTE_PRACH_MOD_WORD2_ADDR A:0x6438ab08
y.create.l HWIO_TX_LTE_PRACH_MOD_WORD3_ADDR A:0x6438ab0c
y.create.l HWIO_TX_LTE_PRACH_MOD_WORD4_ADDR A:0x6438ab10
y.create.l HWIO_TX_LTE_PRACH_MOD_WORD5_ADDR A:0x6438ab14
y.create.l HWIO_TX_LTE_UPPTS_MOD_WORD0_ADDR A:0x6438ac00
y.create.l HWIO_TX_LTE_UPPTS_MOD_WORD1_ADDR A:0x6438ac04
y.create.l HWIO_TX_LTE_UPPTS_MOD_WORD2_ADDR A:0x6438ac08
y.create.l HWIO_TX_LTE_UPPTS_MOD_WORD3_ADDR A:0x6438ac0c
y.create.l HWIO_TX_LTE_UPPTS_MOD_WORD4_ADDR A:0x6438ac10
y.create.l HWIO_TX_LTE_UPPTS_MOD_WORD5_ADDR A:0x6438ac14
y.create.l HWIO_TX_LTE_UPPTS_MOD_WORD6_ADDR A:0x6438ac18
y.create.l HWIO_TX_LTE_UPPTS_MOD_WORD7_ADDR A:0x6438ac1c
y.create.l HWIO_TX_LTE_UPPTS_MOD_WORD8_ADDR A:0x6438ac20
y.create.l HWIO_TX_LTE_UPPTS_MOD_WORD9_ADDR A:0x6438ac24
y.create.l HWIO_TX_LTE_PUSCH_MOD_ACK_WORD0_ADDR A:0x6438ad00
y.create.l HWIO_TX_LTE_PUCCH_MOD_ACK_WORD0_ADDR A:0x6438ae00
y.create.l HWIO_RXFE_ENABLE_ADDR A:0x64360000
y.create.l HWIO_RXFE_ADC0_LOGIC_CFG_ADDR A:0x64360004
y.create.l HWIO_RXFE_ADC1_LOGIC_CFG_ADDR A:0x64360008
y.create.l HWIO_RXFE_WB0_ADCMUX_CFG_ADDR A:0x64360018
y.create.l HWIO_RXFE_WB1_ADCMUX_CFG_ADDR A:0x6436001c
y.create.l HWIO_RXFE_NB0_WBMUX_CFG_ADDR A:0x6436002c
y.create.l HWIO_RXFE_NB1_WBMUX_CFG_ADDR A:0x64360030
y.create.l HWIO_RXFE_NB2_WBMUX_CFG_ADDR A:0x64360034
y.create.l HWIO_RXFE_NB3_WBMUX_CFG_ADDR A:0x64360038
y.create.l HWIO_RXFE_TOP_STATUS_ADDR A:0x6436004c
y.create.l HWIO_RXFE_RFIF_UPDATE_CMD_ADDR A:0x64360050
y.create.l HWIO_RXFE_CMNNOTCH_FILT0_CFG0_ADDR A:0x64360054
y.create.l HWIO_RXFE_CMNNOTCH_FILT0_CFG1_ADDR A:0x64360058
y.create.l HWIO_RXFE_CMNNOTCH_FILT1_CFG0_ADDR A:0x6436005c
y.create.l HWIO_RXFE_CMNNOTCH_FILT1_CFG1_ADDR A:0x64360060
y.create.l HWIO_RXFE_CMNNOTCH_FILT2_CFG0_ADDR A:0x64360064
y.create.l HWIO_RXFE_CMNNOTCH_FILT2_CFG1_ADDR A:0x64360068
y.create.l HWIO_RXFE_CMNNOTCH_FILT3_CFG0_ADDR A:0x6436006c
y.create.l HWIO_RXFE_CMNNOTCH_FILT3_CFG1_ADDR A:0x64360070
y.create.l HWIO_RXFE_CMNNOTCH_FILT01_CFG_ADDR A:0x64360074
y.create.l HWIO_RXFE_CMNNOTCH_FILT23_CFG_ADDR A:0x64360078
y.create.l HWIO_RXFE_ACI_FILT0_CFG_ADDR A:0x6436007c
y.create.l HWIO_RXFE_ACI_FILT1_CFG_ADDR A:0x64360080
y.create.l HWIO_RXFE_TOP_SPARE_REG_ADDR A:0x64360084
y.create.l HWIO_RXFE_DBG_ENABLES_ADDR A:0x64360090
y.create.l HWIO_RXFE_DBG_PROBE_CTL_ADDR A:0x64360094
y.create.l HWIO_RXFE_DBG_CMD_ADDR A:0x64360098
y.create.l HWIO_RXFE_PBS_CFG_ADDR A:0x6436009c
y.create.l HWIO_RXFE_ADC_TEST1_REG_ADC0_ADDR A:0x64362000
y.create.l HWIO_RXFE_ADC_TEST2_REG_ADC0_ADDR A:0x64362004
y.create.l HWIO_RXFE_ADC_TEST3_REG_ADC0_ADDR A:0x64362008
y.create.l HWIO_RXFE_ADC_CONFIG1_REG_ADC0_ADDR A:0x6436200c
y.create.l HWIO_RXFE_ADC_CONFIG2_REG_ADC0_ADDR A:0x64362010
y.create.l HWIO_RXFE_ADC_CONTROL_REG_ADC0_ADDR A:0x64362014
y.create.l HWIO_RXFE_ADC_TEST1_REG_ADC1_ADDR A:0x64362100
y.create.l HWIO_RXFE_ADC_TEST2_REG_ADC1_ADDR A:0x64362104
y.create.l HWIO_RXFE_ADC_TEST3_REG_ADC1_ADDR A:0x64362108
y.create.l HWIO_RXFE_ADC_CONFIG1_REG_ADC1_ADDR A:0x6436210c
y.create.l HWIO_RXFE_ADC_CONFIG2_REG_ADC1_ADDR A:0x64362110
y.create.l HWIO_RXFE_ADC_CONTROL_REG_ADC1_ADDR A:0x64362114
y.create.l HWIO_RXFE_WB_TOP_CTL_WB0_ADDR A:0x64364000
y.create.l HWIO_RXFE_WB_TOP_CMD_WB0_ADDR A:0x64364004
y.create.l HWIO_RXFE_WB_TOP_STATUS_WB0_ADDR A:0x64364008
y.create.l HWIO_RXFE_WB_STOPGATE_ACTION_SAMPLE_WB0_ADDR A:0x6436400c
y.create.l HWIO_RXFE_WB_TIMINGCTL_STATUS_WB0_ADDR A:0x64364010
y.create.l HWIO_RXFE_WB_MISC_CFG_WB0_ADDR A:0x64364014
y.create.l HWIO_RXFE_WB_WBPWR_CFG_WB0_ADDR A:0x64364018
y.create.l HWIO_RXFE_WB_WBPWR_CMD_WB0_ADDR A:0x6436401c
y.create.l HWIO_RXFE_WB_WBPWR_START_ACTION_SAMPLE_WB0_ADDR A:0x64364020
y.create.l HWIO_RXFE_WB_WBPWR_START_MASK_WB0_ADDR A:0x64364024
y.create.l HWIO_RXFE_WB_WBPWR_STOP_ACTION_SAMPLE_WB0_ADDR A:0x64364028
y.create.l HWIO_RXFE_WB_WBPWR_FINAL_ACC_WB0_ADDR A:0x6436402c
y.create.l HWIO_RXFE_WB_WBPWR_CURR_ACC_WB0_ADDR A:0x64364030
y.create.l HWIO_RXFE_WB_WBPWR_MAX_ACC_WB0_ADDR A:0x64364034
y.create.l HWIO_RXFE_WB_WBDC_CFG_WB0_ADDR A:0x64364038
y.create.l HWIO_RXFE_WB_WBDC_CMD_WB0_ADDR A:0x6436403c
y.create.l HWIO_RXFE_WB_WBDC_START_ACTION_SAMPLE_WB0_ADDR A:0x64364040
y.create.l HWIO_RXFE_WB_WBDC_STOP_ACTION_SAMPLE_WB0_ADDR A:0x64364044
y.create.l HWIO_RXFE_WB_WBDC_UPDATE_ACTION_SAMPLE_WB0_ADDR A:0x64364048
y.create.l HWIO_RXFE_WB_WBDC_UPDATE_DELAY_WB0_ADDR A:0x6436404c
y.create.l HWIO_RXFE_WB_WBDC_OVRD_I_WB0_ADDR A:0x64364050
y.create.l HWIO_RXFE_WB_WBDC_OVRD_Q_WB0_ADDR A:0x64364054
y.create.l HWIO_RXFE_WB_WBDC_EST1_CURR_I_WB0_ADDR A:0x64364058
y.create.l HWIO_RXFE_WB_WBDC_EST1_CURR_Q_WB0_ADDR A:0x6436405c
y.create.l HWIO_RXFE_WB_WBDC_EST1_PREV_I_WB0_ADDR A:0x64364060
y.create.l HWIO_RXFE_WB_WBDC_EST1_PREV_Q_WB0_ADDR A:0x64364064
y.create.l HWIO_RXFE_WB_WBDC_EST1_LOAD_I_WB0_ADDR A:0x64364068
y.create.l HWIO_RXFE_WB_WBDC_EST1_LOAD_Q_WB0_ADDR A:0x6436406c
y.create.l HWIO_RXFE_WB_WBDC_EST2_CURR_I_WB0_ADDR A:0x64364070
y.create.l HWIO_RXFE_WB_WBDC_EST2_CURR_Q_WB0_ADDR A:0x64364074
y.create.l HWIO_RXFE_WB_WBDC_EST2_PREV_I_WB0_ADDR A:0x64364078
y.create.l HWIO_RXFE_WB_WBDC_EST2_PREV_Q_WB0_ADDR A:0x6436407c
y.create.l HWIO_RXFE_WB_WBDC_EST2_LOAD_I_WB0_ADDR A:0x64364080
y.create.l HWIO_RXFE_WB_WBDC_EST2_LOAD_Q_WB0_ADDR A:0x64364084
y.create.l HWIO_RXFE_WB_VSRC_CFG_WB0_ADDR A:0x64364088
y.create.l HWIO_RXFE_WB_VSRC_T2BYT1M1_WB0_ADDR A:0x6436408c
y.create.l HWIO_RXFE_WB_VSRC_CMD_WB0_ADDR A:0x64364090
y.create.l HWIO_RXFE_WB_VSRC_STATUS_WB0_ADDR A:0x64364094
y.create.l HWIO_RXFE_WB_VSRC_UPDT_ACTION_SAMPLE_WB0_ADDR A:0x64364098
y.create.l HWIO_RXFE_WB_VSRC_CURR_T1BYT2_WB0_ADDR A:0x6436409c
y.create.l HWIO_RXFE_WB_VSRC_CURR_T2BYT1M1_WB0_ADDR A:0x643640a0
y.create.l HWIO_RXFE_WB_VSRC_SCTR_LOAD_VALUE_WB0_ADDR A:0x643640a4
y.create.l HWIO_RXFE_WB_VSRC_SCTR_WA_WB0_ADDR A:0x643640a8
y.create.l HWIO_RXFE_WB_VSRC_SCTR_SNAPSHOT_WB0_ADDR A:0x643640ac
y.create.l HWIO_RXFE_WB_VSRC_ACC_SNAPSHOT_WB0_ADDR A:0x643640b0
y.create.l HWIO_RXFE_WB_DEC_FILT_CFG_WB0_ADDR A:0x643640b4
y.create.l HWIO_RXFE_WB_IQMC_CFG0_WB0_ADDR A:0x643640b8
y.create.l HWIO_RXFE_WB_IQMC_CFG1_WB0_ADDR A:0x643640bc
y.create.l HWIO_RXFE_WB_IQMC_CURR_VALS_WB0_ADDR A:0x643640c0
y.create.l HWIO_RXFE_WB_IQMC_UPDT_CMD_WB0_ADDR A:0x643640c4
y.create.l HWIO_RXFE_WB_IQMC_UPDT_ACTION_SAMPLE_WB0_ADDR A:0x643640c8
y.create.l HWIO_RXFE_WB_NOTCH_FILT0_CFG0_WB0_ADDR A:0x643640cc
y.create.l HWIO_RXFE_WB_NOTCH_FILT1_CFG0_WB0_ADDR A:0x643640d4
y.create.l HWIO_RXFE_WB_NOTCH_FILT2_CFG0_WB0_ADDR A:0x643640dc
y.create.l HWIO_RXFE_WB_NOTCH_FILT0_CFG1_WB0_ADDR A:0x643640d0
y.create.l HWIO_RXFE_WB_NOTCH_FILT1_CFG1_WB0_ADDR A:0x643640d8
y.create.l HWIO_RXFE_WB_NOTCH_FILT2_CFG1_WB0_ADDR A:0x643640e0
y.create.l HWIO_RXFE_WB_NOTCH_FILT012_CFG_WB0_ADDR A:0x643640e4
y.create.l HWIO_RXFE_WB_SPARE_REG_WB0_ADDR A:0x643640e8
y.create.l HWIO_RXFE_WB_TOP_CTL_WB1_ADDR A:0x64365000
y.create.l HWIO_RXFE_WB_TOP_CMD_WB1_ADDR A:0x64365004
y.create.l HWIO_RXFE_WB_TOP_STATUS_WB1_ADDR A:0x64365008
y.create.l HWIO_RXFE_WB_STOPGATE_ACTION_SAMPLE_WB1_ADDR A:0x6436500c
y.create.l HWIO_RXFE_WB_TIMINGCTL_STATUS_WB1_ADDR A:0x64365010
y.create.l HWIO_RXFE_WB_MISC_CFG_WB1_ADDR A:0x64365014
y.create.l HWIO_RXFE_WB_WBPWR_CFG_WB1_ADDR A:0x64365018
y.create.l HWIO_RXFE_WB_WBPWR_CMD_WB1_ADDR A:0x6436501c
y.create.l HWIO_RXFE_WB_WBPWR_START_ACTION_SAMPLE_WB1_ADDR A:0x64365020
y.create.l HWIO_RXFE_WB_WBPWR_START_MASK_WB1_ADDR A:0x64365024
y.create.l HWIO_RXFE_WB_WBPWR_STOP_ACTION_SAMPLE_WB1_ADDR A:0x64365028
y.create.l HWIO_RXFE_WB_WBPWR_FINAL_ACC_WB1_ADDR A:0x6436502c
y.create.l HWIO_RXFE_WB_WBPWR_CURR_ACC_WB1_ADDR A:0x64365030
y.create.l HWIO_RXFE_WB_WBPWR_MAX_ACC_WB1_ADDR A:0x64365034
y.create.l HWIO_RXFE_WB_WBDC_CFG_WB1_ADDR A:0x64365038
y.create.l HWIO_RXFE_WB_WBDC_CMD_WB1_ADDR A:0x6436503c
y.create.l HWIO_RXFE_WB_WBDC_START_ACTION_SAMPLE_WB1_ADDR A:0x64365040
y.create.l HWIO_RXFE_WB_WBDC_STOP_ACTION_SAMPLE_WB1_ADDR A:0x64365044
y.create.l HWIO_RXFE_WB_WBDC_UPDATE_ACTION_SAMPLE_WB1_ADDR A:0x64365048
y.create.l HWIO_RXFE_WB_WBDC_UPDATE_DELAY_WB1_ADDR A:0x6436504c
y.create.l HWIO_RXFE_WB_WBDC_OVRD_I_WB1_ADDR A:0x64365050
y.create.l HWIO_RXFE_WB_WBDC_OVRD_Q_WB1_ADDR A:0x64365054
y.create.l HWIO_RXFE_WB_WBDC_EST1_CURR_I_WB1_ADDR A:0x64365058
y.create.l HWIO_RXFE_WB_WBDC_EST1_CURR_Q_WB1_ADDR A:0x6436505c
y.create.l HWIO_RXFE_WB_WBDC_EST1_PREV_I_WB1_ADDR A:0x64365060
y.create.l HWIO_RXFE_WB_WBDC_EST1_PREV_Q_WB1_ADDR A:0x64365064
y.create.l HWIO_RXFE_WB_WBDC_EST1_LOAD_I_WB1_ADDR A:0x64365068
y.create.l HWIO_RXFE_WB_WBDC_EST1_LOAD_Q_WB1_ADDR A:0x6436506c
y.create.l HWIO_RXFE_WB_WBDC_EST2_CURR_I_WB1_ADDR A:0x64365070
y.create.l HWIO_RXFE_WB_WBDC_EST2_CURR_Q_WB1_ADDR A:0x64365074
y.create.l HWIO_RXFE_WB_WBDC_EST2_PREV_I_WB1_ADDR A:0x64365078
y.create.l HWIO_RXFE_WB_WBDC_EST2_PREV_Q_WB1_ADDR A:0x6436507c
y.create.l HWIO_RXFE_WB_WBDC_EST2_LOAD_I_WB1_ADDR A:0x64365080
y.create.l HWIO_RXFE_WB_WBDC_EST2_LOAD_Q_WB1_ADDR A:0x64365084
y.create.l HWIO_RXFE_WB_VSRC_CFG_WB1_ADDR A:0x64365088
y.create.l HWIO_RXFE_WB_VSRC_T2BYT1M1_WB1_ADDR A:0x6436508c
y.create.l HWIO_RXFE_WB_VSRC_CMD_WB1_ADDR A:0x64365090
y.create.l HWIO_RXFE_WB_VSRC_STATUS_WB1_ADDR A:0x64365094
y.create.l HWIO_RXFE_WB_VSRC_UPDT_ACTION_SAMPLE_WB1_ADDR A:0x64365098
y.create.l HWIO_RXFE_WB_VSRC_CURR_T1BYT2_WB1_ADDR A:0x6436509c
y.create.l HWIO_RXFE_WB_VSRC_CURR_T2BYT1M1_WB1_ADDR A:0x643650a0
y.create.l HWIO_RXFE_WB_VSRC_SCTR_LOAD_VALUE_WB1_ADDR A:0x643650a4
y.create.l HWIO_RXFE_WB_VSRC_SCTR_WA_WB1_ADDR A:0x643650a8
y.create.l HWIO_RXFE_WB_VSRC_SCTR_SNAPSHOT_WB1_ADDR A:0x643650ac
y.create.l HWIO_RXFE_WB_VSRC_ACC_SNAPSHOT_WB1_ADDR A:0x643650b0
y.create.l HWIO_RXFE_WB_DEC_FILT_CFG_WB1_ADDR A:0x643650b4
y.create.l HWIO_RXFE_WB_IQMC_CFG0_WB1_ADDR A:0x643650b8
y.create.l HWIO_RXFE_WB_IQMC_CFG1_WB1_ADDR A:0x643650bc
y.create.l HWIO_RXFE_WB_IQMC_CURR_VALS_WB1_ADDR A:0x643650c0
y.create.l HWIO_RXFE_WB_IQMC_UPDT_CMD_WB1_ADDR A:0x643650c4
y.create.l HWIO_RXFE_WB_IQMC_UPDT_ACTION_SAMPLE_WB1_ADDR A:0x643650c8
y.create.l HWIO_RXFE_WB_NOTCH_FILT0_CFG0_WB1_ADDR A:0x643650cc
y.create.l HWIO_RXFE_WB_NOTCH_FILT1_CFG0_WB1_ADDR A:0x643650d4
y.create.l HWIO_RXFE_WB_NOTCH_FILT2_CFG0_WB1_ADDR A:0x643650dc
y.create.l HWIO_RXFE_WB_NOTCH_FILT0_CFG1_WB1_ADDR A:0x643650d0
y.create.l HWIO_RXFE_WB_NOTCH_FILT1_CFG1_WB1_ADDR A:0x643650d8
y.create.l HWIO_RXFE_WB_NOTCH_FILT2_CFG1_WB1_ADDR A:0x643650e0
y.create.l HWIO_RXFE_WB_NOTCH_FILT012_CFG_WB1_ADDR A:0x643650e4
y.create.l HWIO_RXFE_WB_SPARE_REG_WB1_ADDR A:0x643650e8
y.create.l HWIO_RXFE_NB_TOP_CTL_NB0_ADDR A:0x64370000
y.create.l HWIO_RXFE_NB_GATE_CMD_NB0_ADDR A:0x64370004
y.create.l HWIO_RXFE_NB_GATE_STATUS_NB0_ADDR A:0x64370008
y.create.l HWIO_RXFE_NB_GATE_ACTION_SAMPLE_NB0_ADDR A:0x6437000c
y.create.l HWIO_RXFE_NB_TIMINGCTL_STATUS_NB0_ADDR A:0x64370010
y.create.l HWIO_RXFE_NB_CSR_CFG_NB0_ADDR A:0x64370014
y.create.l HWIO_RXFE_NB_CSR_CMD_NB0_ADDR A:0x64370018
y.create.l HWIO_RXFE_NB_CSR_PHASEUPDT_ACTION_SAMPLE_NB0_ADDR A:0x6437001c
y.create.l HWIO_RXFE_NB_CSR_FREQUPDT_ACTION_SAMPLE_NB0_ADDR A:0x64370020
y.create.l HWIO_RXFE_NB_CSR_PHASE_OFFSET_NB0_ADDR A:0x64370024
y.create.l HWIO_RXFE_NB_CSR_FREQ_OFFSET_NB0_ADDR A:0x64370028
y.create.l HWIO_RXFE_NB_CSR_CURR_PHASE_OFFSET_NB0_ADDR A:0x6437002c
y.create.l HWIO_RXFE_NB_CSR_CURR_FREQ_OFFSET_NB0_ADDR A:0x64370030
y.create.l HWIO_RXFE_NB_FILTERS_CFG_NB0_ADDR A:0x64370034
y.create.l HWIO_RXFE_NB_ICI_COEF0_NB0_ADDR A:0x6437003c
y.create.l HWIO_RXFE_NB_ICI_COEF1_NB0_ADDR A:0x64370040
y.create.l HWIO_RXFE_NB_ICI_COEF2_NB0_ADDR A:0x64370044
y.create.l HWIO_RXFE_NB_ICI_COEF3_NB0_ADDR A:0x64370048
y.create.l HWIO_RXFE_NB_ICI_COEF4_NB0_ADDR A:0x6437004c
y.create.l HWIO_RXFE_NB_ICI_COEF5_NB0_ADDR A:0x64370050
y.create.l HWIO_RXFE_NB_ICI_COEF6_NB0_ADDR A:0x64370054
y.create.l HWIO_RXFE_NB_ICI_COEF7_NB0_ADDR A:0x64370058
y.create.l HWIO_RXFE_NB_ICI_COEF8_NB0_ADDR A:0x6437005c
y.create.l HWIO_RXFE_NB_ICI_COEF9_NB0_ADDR A:0x64370060
y.create.l HWIO_RXFE_NB_GDA_NB0_ADDR A:0x64370068
y.create.l HWIO_RXFE_NB_NBDC_COMPVAL_I_NB0_ADDR A:0x6437006c
y.create.l HWIO_RXFE_NB_NBDC_COMPVAL_Q_NB0_ADDR A:0x64370070
y.create.l HWIO_RXFE_NB_NBPWR_CFG_NB0_ADDR A:0x64370074
y.create.l HWIO_RXFE_NB_NBPWR_CMD_NB0_ADDR A:0x64370078
y.create.l HWIO_RXFE_NB_NBPWR_START_ACTION_SAMPLE_NB0_ADDR A:0x6437007c
y.create.l HWIO_RXFE_NB_NBPWR_START_MASK_NB0_ADDR A:0x64370080
y.create.l HWIO_RXFE_NB_NBPWR_STOP_ACTION_SAMPLE_NB0_ADDR A:0x64370084
y.create.l HWIO_RXFE_NB_NBPWR_FINAL_ACC_NB0_ADDR A:0x64370088
y.create.l HWIO_RXFE_NB_NBPWR_CURR_ACC_NB0_ADDR A:0x6437008c
y.create.l HWIO_RXFE_NB_NBPWR_MAX_ACC_NB0_ADDR A:0x64370090
y.create.l HWIO_RXFE_NB_DVGA_CFG_NB0_ADDR A:0x64370094
y.create.l HWIO_RXFE_NB_DVGA_RXFE_GAIN_NB0_ADDR A:0x64370098
y.create.l HWIO_RXFE_NB_DVGA_OVERRIDE_DVGA_GAIN_NB0_ADDR A:0x6437009c
y.create.l HWIO_RXFE_NB_DVGA_CMD_NB0_ADDR A:0x643700a0
y.create.l HWIO_RXFE_NB_DVGA_UPDT_ACTION_SAMPLE_NB0_ADDR A:0x643700a4
y.create.l HWIO_RXFE_NB_DVGA_UPDT_MASK_NB0_ADDR A:0x643700a8
y.create.l HWIO_RXFE_NB_FINAL_BITWIDTHS_CFG_NB0_ADDR A:0x643700ac
y.create.l HWIO_RXFE_NB_FINAL_SWAP_NB0_ADDR A:0x643700dc
y.create.l HWIO_RXFE_NB_WTR_CFG_NB0_ADDR A:0x643700b0
y.create.l HWIO_RXFE_NB_WTR_FUNC_CFG_NB0_ADDR A:0x643700b4
y.create.l HWIO_RXFE_NB_WTR_DBG_CFG0_NB0_ADDR A:0x643700b8
y.create.l HWIO_RXFE_NB_WTR_DBG_CFG1_NB0_ADDR A:0x643700bc
y.create.l HWIO_RXFE_NB_WTR_CMD_NB0_ADDR A:0x643700c0
y.create.l HWIO_RXFE_NB_WTR_START_ACTION_SAMPLE_NB0_ADDR A:0x643700c4
y.create.l HWIO_RXFE_NB_WTR_STOP_ACTION_SAMPLE_NB0_ADDR A:0x643700c8
y.create.l HWIO_RXFE_NB_WTR_STATUS_NB0_ADDR A:0x643700d0
y.create.l HWIO_RXFE_NB_WTR_ADDR_SNAPSHOT_NB0_ADDR A:0x643700d4
y.create.l HWIO_RXFE_NB_SPARE_REG_NB0_ADDR A:0x643700d8
y.create.l HWIO_RXFE_NB_TOP_CTL_NB1_ADDR A:0x64371000
y.create.l HWIO_RXFE_NB_GATE_CMD_NB1_ADDR A:0x64371004
y.create.l HWIO_RXFE_NB_GATE_STATUS_NB1_ADDR A:0x64371008
y.create.l HWIO_RXFE_NB_GATE_ACTION_SAMPLE_NB1_ADDR A:0x6437100c
y.create.l HWIO_RXFE_NB_TIMINGCTL_STATUS_NB1_ADDR A:0x64371010
y.create.l HWIO_RXFE_NB_CSR_CFG_NB1_ADDR A:0x64371014
y.create.l HWIO_RXFE_NB_CSR_CMD_NB1_ADDR A:0x64371018
y.create.l HWIO_RXFE_NB_CSR_PHASEUPDT_ACTION_SAMPLE_NB1_ADDR A:0x6437101c
y.create.l HWIO_RXFE_NB_CSR_FREQUPDT_ACTION_SAMPLE_NB1_ADDR A:0x64371020
y.create.l HWIO_RXFE_NB_CSR_PHASE_OFFSET_NB1_ADDR A:0x64371024
y.create.l HWIO_RXFE_NB_CSR_FREQ_OFFSET_NB1_ADDR A:0x64371028
y.create.l HWIO_RXFE_NB_CSR_CURR_PHASE_OFFSET_NB1_ADDR A:0x6437102c
y.create.l HWIO_RXFE_NB_CSR_CURR_FREQ_OFFSET_NB1_ADDR A:0x64371030
y.create.l HWIO_RXFE_NB_FILTERS_CFG_NB1_ADDR A:0x64371034
y.create.l HWIO_RXFE_NB_ICI_COEF0_NB1_ADDR A:0x6437103c
y.create.l HWIO_RXFE_NB_ICI_COEF1_NB1_ADDR A:0x64371040
y.create.l HWIO_RXFE_NB_ICI_COEF2_NB1_ADDR A:0x64371044
y.create.l HWIO_RXFE_NB_ICI_COEF3_NB1_ADDR A:0x64371048
y.create.l HWIO_RXFE_NB_ICI_COEF4_NB1_ADDR A:0x6437104c
y.create.l HWIO_RXFE_NB_ICI_COEF5_NB1_ADDR A:0x64371050
y.create.l HWIO_RXFE_NB_ICI_COEF6_NB1_ADDR A:0x64371054
y.create.l HWIO_RXFE_NB_ICI_COEF7_NB1_ADDR A:0x64371058
y.create.l HWIO_RXFE_NB_ICI_COEF8_NB1_ADDR A:0x6437105c
y.create.l HWIO_RXFE_NB_ICI_COEF9_NB1_ADDR A:0x64371060
y.create.l HWIO_RXFE_NB_GDA_NB1_ADDR A:0x64371068
y.create.l HWIO_RXFE_NB_NBDC_COMPVAL_I_NB1_ADDR A:0x6437106c
y.create.l HWIO_RXFE_NB_NBDC_COMPVAL_Q_NB1_ADDR A:0x64371070
y.create.l HWIO_RXFE_NB_NBPWR_CFG_NB1_ADDR A:0x64371074
y.create.l HWIO_RXFE_NB_NBPWR_CMD_NB1_ADDR A:0x64371078
y.create.l HWIO_RXFE_NB_NBPWR_START_ACTION_SAMPLE_NB1_ADDR A:0x6437107c
y.create.l HWIO_RXFE_NB_NBPWR_START_MASK_NB1_ADDR A:0x64371080
y.create.l HWIO_RXFE_NB_NBPWR_STOP_ACTION_SAMPLE_NB1_ADDR A:0x64371084
y.create.l HWIO_RXFE_NB_NBPWR_FINAL_ACC_NB1_ADDR A:0x64371088
y.create.l HWIO_RXFE_NB_NBPWR_CURR_ACC_NB1_ADDR A:0x6437108c
y.create.l HWIO_RXFE_NB_NBPWR_MAX_ACC_NB1_ADDR A:0x64371090
y.create.l HWIO_RXFE_NB_DVGA_CFG_NB1_ADDR A:0x64371094
y.create.l HWIO_RXFE_NB_DVGA_RXFE_GAIN_NB1_ADDR A:0x64371098
y.create.l HWIO_RXFE_NB_DVGA_OVERRIDE_DVGA_GAIN_NB1_ADDR A:0x6437109c
y.create.l HWIO_RXFE_NB_DVGA_CMD_NB1_ADDR A:0x643710a0
y.create.l HWIO_RXFE_NB_DVGA_UPDT_ACTION_SAMPLE_NB1_ADDR A:0x643710a4
y.create.l HWIO_RXFE_NB_DVGA_UPDT_MASK_NB1_ADDR A:0x643710a8
y.create.l HWIO_RXFE_NB_FINAL_BITWIDTHS_CFG_NB1_ADDR A:0x643710ac
y.create.l HWIO_RXFE_NB_FINAL_SWAP_NB1_ADDR A:0x643710dc
y.create.l HWIO_RXFE_NB_WTR_CFG_NB1_ADDR A:0x643710b0
y.create.l HWIO_RXFE_NB_WTR_FUNC_CFG_NB1_ADDR A:0x643710b4
y.create.l HWIO_RXFE_NB_WTR_DBG_CFG0_NB1_ADDR A:0x643710b8
y.create.l HWIO_RXFE_NB_WTR_DBG_CFG1_NB1_ADDR A:0x643710bc
y.create.l HWIO_RXFE_NB_WTR_CMD_NB1_ADDR A:0x643710c0
y.create.l HWIO_RXFE_NB_WTR_START_ACTION_SAMPLE_NB1_ADDR A:0x643710c4
y.create.l HWIO_RXFE_NB_WTR_STOP_ACTION_SAMPLE_NB1_ADDR A:0x643710c8
y.create.l HWIO_RXFE_NB_WTR_STATUS_NB1_ADDR A:0x643710d0
y.create.l HWIO_RXFE_NB_WTR_ADDR_SNAPSHOT_NB1_ADDR A:0x643710d4
y.create.l HWIO_RXFE_NB_SPARE_REG_NB1_ADDR A:0x643710d8
y.create.l HWIO_RXFE_NB_TOP_CTL_NB2_ADDR A:0x64372000
y.create.l HWIO_RXFE_NB_GATE_CMD_NB2_ADDR A:0x64372004
y.create.l HWIO_RXFE_NB_GATE_STATUS_NB2_ADDR A:0x64372008
y.create.l HWIO_RXFE_NB_GATE_ACTION_SAMPLE_NB2_ADDR A:0x6437200c
y.create.l HWIO_RXFE_NB_TIMINGCTL_STATUS_NB2_ADDR A:0x64372010
y.create.l HWIO_RXFE_NB_CSR_CFG_NB2_ADDR A:0x64372014
y.create.l HWIO_RXFE_NB_CSR_CMD_NB2_ADDR A:0x64372018
y.create.l HWIO_RXFE_NB_CSR_PHASEUPDT_ACTION_SAMPLE_NB2_ADDR A:0x6437201c
y.create.l HWIO_RXFE_NB_CSR_FREQUPDT_ACTION_SAMPLE_NB2_ADDR A:0x64372020
y.create.l HWIO_RXFE_NB_CSR_PHASE_OFFSET_NB2_ADDR A:0x64372024
y.create.l HWIO_RXFE_NB_CSR_FREQ_OFFSET_NB2_ADDR A:0x64372028
y.create.l HWIO_RXFE_NB_CSR_CURR_PHASE_OFFSET_NB2_ADDR A:0x6437202c
y.create.l HWIO_RXFE_NB_CSR_CURR_FREQ_OFFSET_NB2_ADDR A:0x64372030
y.create.l HWIO_RXFE_NB_FILTERS_CFG_NB2_ADDR A:0x64372034
y.create.l HWIO_RXFE_NB_ICI_COEF0_NB2_ADDR A:0x6437203c
y.create.l HWIO_RXFE_NB_ICI_COEF1_NB2_ADDR A:0x64372040
y.create.l HWIO_RXFE_NB_ICI_COEF2_NB2_ADDR A:0x64372044
y.create.l HWIO_RXFE_NB_ICI_COEF3_NB2_ADDR A:0x64372048
y.create.l HWIO_RXFE_NB_ICI_COEF4_NB2_ADDR A:0x6437204c
y.create.l HWIO_RXFE_NB_ICI_COEF5_NB2_ADDR A:0x64372050
y.create.l HWIO_RXFE_NB_ICI_COEF6_NB2_ADDR A:0x64372054
y.create.l HWIO_RXFE_NB_ICI_COEF7_NB2_ADDR A:0x64372058
y.create.l HWIO_RXFE_NB_ICI_COEF8_NB2_ADDR A:0x6437205c
y.create.l HWIO_RXFE_NB_ICI_COEF9_NB2_ADDR A:0x64372060
y.create.l HWIO_RXFE_NB_GDA_NB2_ADDR A:0x64372068
y.create.l HWIO_RXFE_NB_NBDC_COMPVAL_I_NB2_ADDR A:0x6437206c
y.create.l HWIO_RXFE_NB_NBDC_COMPVAL_Q_NB2_ADDR A:0x64372070
y.create.l HWIO_RXFE_NB_NBPWR_CFG_NB2_ADDR A:0x64372074
y.create.l HWIO_RXFE_NB_NBPWR_CMD_NB2_ADDR A:0x64372078
y.create.l HWIO_RXFE_NB_NBPWR_START_ACTION_SAMPLE_NB2_ADDR A:0x6437207c
y.create.l HWIO_RXFE_NB_NBPWR_START_MASK_NB2_ADDR A:0x64372080
y.create.l HWIO_RXFE_NB_NBPWR_STOP_ACTION_SAMPLE_NB2_ADDR A:0x64372084
y.create.l HWIO_RXFE_NB_NBPWR_FINAL_ACC_NB2_ADDR A:0x64372088
y.create.l HWIO_RXFE_NB_NBPWR_CURR_ACC_NB2_ADDR A:0x6437208c
y.create.l HWIO_RXFE_NB_NBPWR_MAX_ACC_NB2_ADDR A:0x64372090
y.create.l HWIO_RXFE_NB_DVGA_CFG_NB2_ADDR A:0x64372094
y.create.l HWIO_RXFE_NB_DVGA_RXFE_GAIN_NB2_ADDR A:0x64372098
y.create.l HWIO_RXFE_NB_DVGA_OVERRIDE_DVGA_GAIN_NB2_ADDR A:0x6437209c
y.create.l HWIO_RXFE_NB_DVGA_CMD_NB2_ADDR A:0x643720a0
y.create.l HWIO_RXFE_NB_DVGA_UPDT_ACTION_SAMPLE_NB2_ADDR A:0x643720a4
y.create.l HWIO_RXFE_NB_DVGA_UPDT_MASK_NB2_ADDR A:0x643720a8
y.create.l HWIO_RXFE_NB_FINAL_BITWIDTHS_CFG_NB2_ADDR A:0x643720ac
y.create.l HWIO_RXFE_NB_FINAL_SWAP_NB2_ADDR A:0x643720dc
y.create.l HWIO_RXFE_NB_WTR_CFG_NB2_ADDR A:0x643720b0
y.create.l HWIO_RXFE_NB_WTR_FUNC_CFG_NB2_ADDR A:0x643720b4
y.create.l HWIO_RXFE_NB_WTR_DBG_CFG0_NB2_ADDR A:0x643720b8
y.create.l HWIO_RXFE_NB_WTR_DBG_CFG1_NB2_ADDR A:0x643720bc
y.create.l HWIO_RXFE_NB_WTR_CMD_NB2_ADDR A:0x643720c0
y.create.l HWIO_RXFE_NB_WTR_START_ACTION_SAMPLE_NB2_ADDR A:0x643720c4
y.create.l HWIO_RXFE_NB_WTR_STOP_ACTION_SAMPLE_NB2_ADDR A:0x643720c8
y.create.l HWIO_RXFE_NB_WTR_STATUS_NB2_ADDR A:0x643720d0
y.create.l HWIO_RXFE_NB_WTR_ADDR_SNAPSHOT_NB2_ADDR A:0x643720d4
y.create.l HWIO_RXFE_NB_SPARE_REG_NB2_ADDR A:0x643720d8
y.create.l HWIO_RXFE_NB_TOP_CTL_NB3_ADDR A:0x64373000
y.create.l HWIO_RXFE_NB_GATE_CMD_NB3_ADDR A:0x64373004
y.create.l HWIO_RXFE_NB_GATE_STATUS_NB3_ADDR A:0x64373008
y.create.l HWIO_RXFE_NB_GATE_ACTION_SAMPLE_NB3_ADDR A:0x6437300c
y.create.l HWIO_RXFE_NB_TIMINGCTL_STATUS_NB3_ADDR A:0x64373010
y.create.l HWIO_RXFE_NB_CSR_CFG_NB3_ADDR A:0x64373014
y.create.l HWIO_RXFE_NB_CSR_CMD_NB3_ADDR A:0x64373018
y.create.l HWIO_RXFE_NB_CSR_PHASEUPDT_ACTION_SAMPLE_NB3_ADDR A:0x6437301c
y.create.l HWIO_RXFE_NB_CSR_FREQUPDT_ACTION_SAMPLE_NB3_ADDR A:0x64373020
y.create.l HWIO_RXFE_NB_CSR_PHASE_OFFSET_NB3_ADDR A:0x64373024
y.create.l HWIO_RXFE_NB_CSR_FREQ_OFFSET_NB3_ADDR A:0x64373028
y.create.l HWIO_RXFE_NB_CSR_CURR_PHASE_OFFSET_NB3_ADDR A:0x6437302c
y.create.l HWIO_RXFE_NB_CSR_CURR_FREQ_OFFSET_NB3_ADDR A:0x64373030
y.create.l HWIO_RXFE_NB_FILTERS_CFG_NB3_ADDR A:0x64373034
y.create.l HWIO_RXFE_NB_ICI_COEF0_NB3_ADDR A:0x6437303c
y.create.l HWIO_RXFE_NB_ICI_COEF1_NB3_ADDR A:0x64373040
y.create.l HWIO_RXFE_NB_ICI_COEF2_NB3_ADDR A:0x64373044
y.create.l HWIO_RXFE_NB_ICI_COEF3_NB3_ADDR A:0x64373048
y.create.l HWIO_RXFE_NB_ICI_COEF4_NB3_ADDR A:0x6437304c
y.create.l HWIO_RXFE_NB_ICI_COEF5_NB3_ADDR A:0x64373050
y.create.l HWIO_RXFE_NB_ICI_COEF6_NB3_ADDR A:0x64373054
y.create.l HWIO_RXFE_NB_ICI_COEF7_NB3_ADDR A:0x64373058
y.create.l HWIO_RXFE_NB_ICI_COEF8_NB3_ADDR A:0x6437305c
y.create.l HWIO_RXFE_NB_ICI_COEF9_NB3_ADDR A:0x64373060
y.create.l HWIO_RXFE_NB_GDA_NB3_ADDR A:0x64373068
y.create.l HWIO_RXFE_NB_NBDC_COMPVAL_I_NB3_ADDR A:0x6437306c
y.create.l HWIO_RXFE_NB_NBDC_COMPVAL_Q_NB3_ADDR A:0x64373070
y.create.l HWIO_RXFE_NB_NBPWR_CFG_NB3_ADDR A:0x64373074
y.create.l HWIO_RXFE_NB_NBPWR_CMD_NB3_ADDR A:0x64373078
y.create.l HWIO_RXFE_NB_NBPWR_START_ACTION_SAMPLE_NB3_ADDR A:0x6437307c
y.create.l HWIO_RXFE_NB_NBPWR_START_MASK_NB3_ADDR A:0x64373080
y.create.l HWIO_RXFE_NB_NBPWR_STOP_ACTION_SAMPLE_NB3_ADDR A:0x64373084
y.create.l HWIO_RXFE_NB_NBPWR_FINAL_ACC_NB3_ADDR A:0x64373088
y.create.l HWIO_RXFE_NB_NBPWR_CURR_ACC_NB3_ADDR A:0x6437308c
y.create.l HWIO_RXFE_NB_NBPWR_MAX_ACC_NB3_ADDR A:0x64373090
y.create.l HWIO_RXFE_NB_DVGA_CFG_NB3_ADDR A:0x64373094
y.create.l HWIO_RXFE_NB_DVGA_RXFE_GAIN_NB3_ADDR A:0x64373098
y.create.l HWIO_RXFE_NB_DVGA_OVERRIDE_DVGA_GAIN_NB3_ADDR A:0x6437309c
y.create.l HWIO_RXFE_NB_DVGA_CMD_NB3_ADDR A:0x643730a0
y.create.l HWIO_RXFE_NB_DVGA_UPDT_ACTION_SAMPLE_NB3_ADDR A:0x643730a4
y.create.l HWIO_RXFE_NB_DVGA_UPDT_MASK_NB3_ADDR A:0x643730a8
y.create.l HWIO_RXFE_NB_FINAL_BITWIDTHS_CFG_NB3_ADDR A:0x643730ac
y.create.l HWIO_RXFE_NB_FINAL_SWAP_NB3_ADDR A:0x643730dc
y.create.l HWIO_RXFE_NB_WTR_CFG_NB3_ADDR A:0x643730b0
y.create.l HWIO_RXFE_NB_WTR_FUNC_CFG_NB3_ADDR A:0x643730b4
y.create.l HWIO_RXFE_NB_WTR_DBG_CFG0_NB3_ADDR A:0x643730b8
y.create.l HWIO_RXFE_NB_WTR_DBG_CFG1_NB3_ADDR A:0x643730bc
y.create.l HWIO_RXFE_NB_WTR_CMD_NB3_ADDR A:0x643730c0
y.create.l HWIO_RXFE_NB_WTR_START_ACTION_SAMPLE_NB3_ADDR A:0x643730c4
y.create.l HWIO_RXFE_NB_WTR_STOP_ACTION_SAMPLE_NB3_ADDR A:0x643730c8
y.create.l HWIO_RXFE_NB_WTR_STATUS_NB3_ADDR A:0x643730d0
y.create.l HWIO_RXFE_NB_WTR_ADDR_SNAPSHOT_NB3_ADDR A:0x643730d4
y.create.l HWIO_RXFE_NB_SPARE_REG_NB3_ADDR A:0x643730d8
y.create.l HWIO_RXFE_WRTR0_CFG0_ADDR A:0x6437f000
y.create.l HWIO_RXFE_WRTR1_CFG0_ADDR A:0x6437f008
y.create.l HWIO_RXFE_WRTR2_CFG0_ADDR A:0x6437f010
y.create.l HWIO_RXFE_WRTR3_CFG0_ADDR A:0x6437f018
y.create.l HWIO_RXFE_WRTR0_CFG1_ADDR A:0x6437f004
y.create.l HWIO_RXFE_WRTR1_CFG1_ADDR A:0x6437f00c
y.create.l HWIO_RXFE_WRTR2_CFG1_ADDR A:0x6437f014
y.create.l HWIO_RXFE_WRTR3_CFG1_ADDR A:0x6437f01c
y.create.l HWIO_RXFE_WRTR_XFER_CTL_ADDR A:0x6437f040
y.create.l HWIO_RXFE_BRDG_CTL_ADDR A:0x6437f044
y.create.l HWIO_RXFE_BRDG_STATUS_ADDR A:0x6437f048
y.create.l HWIO_RXFE_BRDG_CLEAR_ADDR A:0x6437f04c
y.create.l HWIO_RXFE_BRDG_ARB_PRI_ADDR A:0x6437f050
y.create.l HWIO_RXFE_BRDG_AXI_PRI_ADDR A:0x6437f054
y.create.l HWIO_RXFE_BRDG_AXI_IDLE_CNT0_ADDR A:0x6437f058
y.create.l HWIO_RXFE_BRDG_AXI_IDLE_CNT1_ADDR A:0x6437f060
y.create.l HWIO_RXFE_BRDG_AXI_IDLE_CNT2_ADDR A:0x6437f068
y.create.l HWIO_RXFE_BRDG_AXI_IDLE_CNT3_ADDR A:0x6437f070
y.create.l HWIO_DEMBACK_EN_ADDR A:0x64340000
y.create.l HWIO_DEMBACK_MODE_SEL_ADDR A:0x64340004
y.create.l HWIO_DEMBACK_AHB_ERR_ADDR A:0x64340008
y.create.l HWIO_DEMBACK_MISC_ERR_DET_ADDR A:0x64340010
y.create.l HWIO_DEMBACK_MISC_ERR_CLR_ADDR A:0x64340014
y.create.l HWIO_DEMBACK_RDR0_XFER_CTL_ADDR A:0x64340100
y.create.l HWIO_DEMBACK_RDR0_CTX0_CFG0_ADDR A:0x64340108
y.create.l HWIO_DEMBACK_RDR0_CTX0_CFG1_ADDR A:0x6434010c
y.create.l HWIO_DEMBACK_RDR0_CTX1_CFG0_ADDR A:0x64340110
y.create.l HWIO_DEMBACK_RDR0_CTX1_CFG1_ADDR A:0x64340114
y.create.l HWIO_DEMBACK_RDR0_CTX2_CFG0_ADDR A:0x64340118
y.create.l HWIO_DEMBACK_RDR0_CTX2_CFG1_ADDR A:0x6434011c
y.create.l HWIO_DEMBACK_RDR0_CTX3_CFG0_ADDR A:0x64340120
y.create.l HWIO_DEMBACK_RDR0_CTX3_CFG1_ADDR A:0x64340124
y.create.l HWIO_DEMBACK_RDR1_XFER_CTL_ADDR A:0x64340148
y.create.l HWIO_DEMBACK_RDR1_CFG0_ADDR A:0x6434014c
y.create.l HWIO_DEMBACK_RDR1_CFG1_ADDR A:0x64340150
y.create.l HWIO_DEMBACK_RDR2_XFER_CTL_ADDR A:0x64340154
y.create.l HWIO_DEMBACK_RDR2_CFG0_ADDR A:0x64340158
y.create.l HWIO_DEMBACK_RDR2_CFG1_ADDR A:0x6434015c
y.create.l HWIO_DEMBACK_BRDG_CTL_ADDR A:0x64340190
y.create.l HWIO_DEMBACK_BRDG_STATUS_ADDR A:0x64340194
y.create.l HWIO_DEMBACK_BRDG_CLEAR_ADDR A:0x64340198
y.create.l HWIO_DEMBACK_BRDG_AXI_PRI_ADDR A:0x643401a0
y.create.l HWIO_DEMBACK_DBG_CTL_ADDR A:0x643401ac
y.create.l HWIO_LTE_DBE_PHICH_STATUS_ADDR A:0x64341000
y.create.l HWIO_LTE_DBE_PCFICH_STATUS_ADDR A:0x64341004
y.create.l HWIO_LTE_DBE_SCRAMBLE_SEED_FF_X1_SEED_ADDR A:0x64341008
y.create.l HWIO_LTE_DBE_TESTBUS_ENABLE_ADDR A:0x6434100c
y.create.l HWIO_LTE_DBE_TESTBUS_STATUS_ADDR A:0x64341010
y.create.l HWIO_LTE_DBE_PBCH_CMD_COUNT_ADDR A:0x64341014
y.create.l HWIO_LTE_DBE_PDCCH_CMD_COUNT_ADDR A:0x64341018
y.create.l HWIO_LTE_DBE_PDSCH_CMD_COUNT_ADDR A:0x6434101c
y.create.l HWIO_LTE_DBE_PBCH_DONE_COUNT_ADDR A:0x64341020
y.create.l HWIO_LTE_DBE_PDCCH_DONE_COUNT_ADDR A:0x64341024
y.create.l HWIO_LTE_DBE_PDSCH_DONE_COUNT_ADDR A:0x64341028
y.create.l HWIO_LTE_CFG_ADDR A:0x6434102c
y.create.l HWIO_DBACK_AMP_EST0_0_ADDR A:0x64342000
y.create.l HWIO_DBACK_AMP_EST0_1_ADDR A:0x64342008
y.create.l HWIO_DBACK_AMP_EST0_2_ADDR A:0x64342010
y.create.l HWIO_DBACK_AMP_EST0_3_ADDR A:0x64342018
y.create.l HWIO_DBACK_AMP_EST0_4_ADDR A:0x64342020
y.create.l HWIO_DBACK_AMP_EST0_5_ADDR A:0x64342028
y.create.l HWIO_DBACK_ENG_EST0_0_ADDR A:0x64342004
y.create.l HWIO_DBACK_ENG_EST0_1_ADDR A:0x6434200c
y.create.l HWIO_DBACK_ENG_EST0_2_ADDR A:0x64342014
y.create.l HWIO_DBACK_ENG_EST0_3_ADDR A:0x6434201c
y.create.l HWIO_DBACK_ENG_EST0_4_ADDR A:0x64342024
y.create.l HWIO_DBACK_ENG_EST0_5_ADDR A:0x6434202c
y.create.l HWIO_DBACK_AMP_EST1_0_ADDR A:0x64342030
y.create.l HWIO_DBACK_AMP_EST1_1_ADDR A:0x64342038
y.create.l HWIO_DBACK_AMP_EST1_2_ADDR A:0x64342040
y.create.l HWIO_DBACK_AMP_EST1_3_ADDR A:0x64342048
y.create.l HWIO_DBACK_AMP_EST1_4_ADDR A:0x64342050
y.create.l HWIO_DBACK_AMP_EST1_5_ADDR A:0x64342058
y.create.l HWIO_DBACK_ENG_EST1_0_ADDR A:0x64342034
y.create.l HWIO_DBACK_ENG_EST1_1_ADDR A:0x6434203c
y.create.l HWIO_DBACK_ENG_EST1_2_ADDR A:0x64342044
y.create.l HWIO_DBACK_ENG_EST1_3_ADDR A:0x6434204c
y.create.l HWIO_DBACK_ENG_EST1_4_ADDR A:0x64342054
y.create.l HWIO_DBACK_ENG_EST1_5_ADDR A:0x6434205c
y.create.l HWIO_DBACK_HS_CH0_PART1_DEC_DATA0_ADDR A:0x64342060
y.create.l HWIO_DBACK_HS_CH1_PART1_DEC_DATA0_ADDR A:0x6434206c
y.create.l HWIO_DBACK_HS_CH2_PART1_DEC_DATA0_ADDR A:0x64342078
y.create.l HWIO_DBACK_HS_CH3_PART1_DEC_DATA0_ADDR A:0x64342084
y.create.l HWIO_DBACK_HS_CH4_PART1_DEC_DATA0_ADDR A:0x64342090
y.create.l HWIO_DBACK_HS_CH5_PART1_DEC_DATA0_ADDR A:0x6434209c
y.create.l HWIO_DBACK_HS_CH6_PART1_DEC_DATA0_ADDR A:0x643420a8
y.create.l HWIO_DBACK_HS_CH7_PART1_DEC_DATA0_ADDR A:0x643420b4
y.create.l HWIO_DBACK_HS_CH8_PART1_DEC_DATA0_ADDR A:0x643420c0
y.create.l HWIO_DBACK_HS_CH9_PART1_DEC_DATA0_ADDR A:0x643420cc
y.create.l HWIO_DBACK_HS_CH0_PART1_DEC_STAT_ADDR A:0x64342064
y.create.l HWIO_DBACK_HS_CH1_PART1_DEC_STAT_ADDR A:0x64342070
y.create.l HWIO_DBACK_HS_CH2_PART1_DEC_STAT_ADDR A:0x6434207c
y.create.l HWIO_DBACK_HS_CH3_PART1_DEC_STAT_ADDR A:0x64342088
y.create.l HWIO_DBACK_HS_CH4_PART1_DEC_STAT_ADDR A:0x64342094
y.create.l HWIO_DBACK_HS_CH5_PART1_DEC_STAT_ADDR A:0x643420a0
y.create.l HWIO_DBACK_HS_CH6_PART1_DEC_STAT_ADDR A:0x643420ac
y.create.l HWIO_DBACK_HS_CH7_PART1_DEC_STAT_ADDR A:0x643420b8
y.create.l HWIO_DBACK_HS_CH8_PART1_DEC_STAT_ADDR A:0x643420c4
y.create.l HWIO_DBACK_HS_CH9_PART1_DEC_STAT_ADDR A:0x643420d0
y.create.l HWIO_DBACK_HS_CH0_SLOT1_AE_EST_ADDR A:0x64342068
y.create.l HWIO_DBACK_HS_CH1_SLOT1_AE_EST_ADDR A:0x64342074
y.create.l HWIO_DBACK_HS_CH2_SLOT1_AE_EST_ADDR A:0x64342080
y.create.l HWIO_DBACK_HS_CH3_SLOT1_AE_EST_ADDR A:0x6434208c
y.create.l HWIO_DBACK_HS_CH4_SLOT1_AE_EST_ADDR A:0x64342098
y.create.l HWIO_DBACK_HS_CH5_SLOT1_AE_EST_ADDR A:0x643420a4
y.create.l HWIO_DBACK_HS_CH6_SLOT1_AE_EST_ADDR A:0x643420b0
y.create.l HWIO_DBACK_HS_CH7_SLOT1_AE_EST_ADDR A:0x643420bc
y.create.l HWIO_DBACK_HS_CH8_SLOT1_AE_EST_ADDR A:0x643420c8
y.create.l HWIO_DBACK_HS_CH9_SLOT1_AE_EST_ADDR A:0x643420d4
y.create.l HWIO_DBACK_HS_CH0_PART2_DEC_DATA1_ADDR A:0x643420d8
y.create.l HWIO_DBACK_HS_CH1_PART2_DEC_DATA1_ADDR A:0x643420e8
y.create.l HWIO_DBACK_HS_CH2_PART2_DEC_DATA1_ADDR A:0x643420f8
y.create.l HWIO_DBACK_HS_CH3_PART2_DEC_DATA1_ADDR A:0x64342108
y.create.l HWIO_DBACK_HS_CH4_PART2_DEC_DATA1_ADDR A:0x64342118
y.create.l HWIO_DBACK_HS_CH5_PART2_DEC_DATA1_ADDR A:0x64342128
y.create.l HWIO_DBACK_HS_CH6_PART2_DEC_DATA1_ADDR A:0x64342138
y.create.l HWIO_DBACK_HS_CH7_PART2_DEC_DATA1_ADDR A:0x64342148
y.create.l HWIO_DBACK_HS_CH8_PART2_DEC_DATA1_ADDR A:0x64342158
y.create.l HWIO_DBACK_HS_CH9_PART2_DEC_DATA1_ADDR A:0x64342168
y.create.l HWIO_DBACK_HS_CH0_PART2_DEC_STAT_ADDR A:0x643420dc
y.create.l HWIO_DBACK_HS_CH1_PART2_DEC_STAT_ADDR A:0x643420ec
y.create.l HWIO_DBACK_HS_CH2_PART2_DEC_STAT_ADDR A:0x643420fc
y.create.l HWIO_DBACK_HS_CH3_PART2_DEC_STAT_ADDR A:0x6434210c
y.create.l HWIO_DBACK_HS_CH4_PART2_DEC_STAT_ADDR A:0x6434211c
y.create.l HWIO_DBACK_HS_CH5_PART2_DEC_STAT_ADDR A:0x6434212c
y.create.l HWIO_DBACK_HS_CH6_PART2_DEC_STAT_ADDR A:0x6434213c
y.create.l HWIO_DBACK_HS_CH7_PART2_DEC_STAT_ADDR A:0x6434214c
y.create.l HWIO_DBACK_HS_CH8_PART2_DEC_STAT_ADDR A:0x6434215c
y.create.l HWIO_DBACK_HS_CH9_PART2_DEC_STAT_ADDR A:0x6434216c
y.create.l HWIO_DBACK_HS_CH0_SLOT2_AE_EST_ADDR A:0x643420e0
y.create.l HWIO_DBACK_HS_CH1_SLOT2_AE_EST_ADDR A:0x643420f0
y.create.l HWIO_DBACK_HS_CH2_SLOT2_AE_EST_ADDR A:0x64342100
y.create.l HWIO_DBACK_HS_CH3_SLOT2_AE_EST_ADDR A:0x64342110
y.create.l HWIO_DBACK_HS_CH4_SLOT2_AE_EST_ADDR A:0x64342120
y.create.l HWIO_DBACK_HS_CH5_SLOT2_AE_EST_ADDR A:0x64342130
y.create.l HWIO_DBACK_HS_CH6_SLOT2_AE_EST_ADDR A:0x64342140
y.create.l HWIO_DBACK_HS_CH7_SLOT2_AE_EST_ADDR A:0x64342150
y.create.l HWIO_DBACK_HS_CH8_SLOT2_AE_EST_ADDR A:0x64342160
y.create.l HWIO_DBACK_HS_CH9_SLOT2_AE_EST_ADDR A:0x64342170
y.create.l HWIO_DBACK_HS_CH0_SLOT3_AE_EST_ADDR A:0x643420e4
y.create.l HWIO_DBACK_HS_CH1_SLOT3_AE_EST_ADDR A:0x643420f4
y.create.l HWIO_DBACK_HS_CH2_SLOT3_AE_EST_ADDR A:0x64342104
y.create.l HWIO_DBACK_HS_CH3_SLOT3_AE_EST_ADDR A:0x64342114
y.create.l HWIO_DBACK_HS_CH4_SLOT3_AE_EST_ADDR A:0x64342124
y.create.l HWIO_DBACK_HS_CH5_SLOT3_AE_EST_ADDR A:0x64342134
y.create.l HWIO_DBACK_HS_CH6_SLOT3_AE_EST_ADDR A:0x64342144
y.create.l HWIO_DBACK_HS_CH7_SLOT3_AE_EST_ADDR A:0x64342154
y.create.l HWIO_DBACK_HS_CH8_SLOT3_AE_EST_ADDR A:0x64342164
y.create.l HWIO_DBACK_HS_CH9_SLOT3_AE_EST_ADDR A:0x64342174
y.create.l HWIO_DBACK_EAGCH_DEC_DATA_ADDR A:0x64342178
y.create.l HWIO_DBACK_EAGCH_DEC_STAT_ADDR A:0x6434217c
y.create.l HWIO_DBACK_EAGCH_METRIC_ADDR A:0x64342180
y.create.l HWIO_DBACK_HSSCCH_CTL1_ADDR A:0x64342184
y.create.l HWIO_DBACK_HSSCCH_CTL2_ADDR A:0x64342188
y.create.l HWIO_HS_SCCH_PART2_DECODE_MAP_ADDR A:0x6434218c
y.create.l HWIO_DBACK_CH0_UEID_MASK_0_ADDR A:0x64342190
y.create.l HWIO_DBACK_CH1_UEID_MASK_0_ADDR A:0x64342194
y.create.l HWIO_DBACK_CH2_UEID_MASK_0_ADDR A:0x64342198
y.create.l HWIO_DBACK_CH3_UEID_MASK_0_ADDR A:0x6434219c
y.create.l HWIO_DBACK_CH4_UEID_MASK_0_ADDR A:0x643421a0
y.create.l HWIO_DBACK_CH5_UEID_MASK_0_ADDR A:0x643421a4
y.create.l HWIO_DBACK_CH6_UEID_MASK_0_ADDR A:0x643421a8
y.create.l HWIO_DBACK_CH7_UEID_MASK_0_ADDR A:0x643421ac
y.create.l HWIO_DBACK_CH8_UEID_MASK_0_ADDR A:0x643421b0
y.create.l HWIO_DBACK_CH9_UEID_MASK_0_ADDR A:0x643421b4
y.create.l HWIO_DBACK_CH0_UEID_MASK_1_ADDR A:0x643421b8
y.create.l HWIO_DBACK_CH1_UEID_MASK_1_ADDR A:0x643421bc
y.create.l HWIO_DBACK_CH2_UEID_MASK_1_ADDR A:0x643421c0
y.create.l HWIO_DBACK_CH3_UEID_MASK_1_ADDR A:0x643421c4
y.create.l HWIO_DBACK_CH4_UEID_MASK_1_ADDR A:0x643421c8
y.create.l HWIO_DBACK_CH5_UEID_MASK_1_ADDR A:0x643421cc
y.create.l HWIO_DBACK_CH6_UEID_MASK_1_ADDR A:0x643421d0
y.create.l HWIO_DBACK_CH7_UEID_MASK_1_ADDR A:0x643421d4
y.create.l HWIO_DBACK_CH8_UEID_MASK_1_ADDR A:0x643421d8
y.create.l HWIO_DBACK_CH9_UEID_MASK_1_ADDR A:0x643421dc
y.create.l HWIO_DBACK_HSSCCH_PART1_TRIGGER_ADDR A:0x643421e0
y.create.l HWIO_DBACK_HSSCCH_YAM_THRES_ADDR A:0x643421e4
y.create.l HWIO_DBACK_HSSCCH_PART2_TRIGGER_ADDR A:0x643421e8
y.create.l HWIO_DBACK_HSSCCH_STATUS_ADDR A:0x643421ec
y.create.l HWIO_DBACK_EAGCH_CONFIG_ADDR A:0x643421f0
y.create.l HWIO_DBACK_EAGCH_CTL_ADDR A:0x643421f4
y.create.l HWIO_DBACK_EAGCH_TRIGGER_ADDR A:0x643421f8
y.create.l HWIO_DBACK_EAGCH_RM_PATTERN_0_ADDR A:0x643421fc
y.create.l HWIO_DBACK_EAGCH_RM_PATTERN_1_ADDR A:0x64342200
y.create.l HWIO_DBACK_EAGCH_RM_PATTERN_2_ADDR A:0x64342204
y.create.l HWIO_DBACK_HS_EUL_CTL_CH_RST_ADDR A:0x64342208
y.create.l HWIO_DBACK_NONHS_WCB_SIZE_ADDR A:0x6434220c
y.create.l HWIO_DBACK_HS_WCB_SIZE_ADDR A:0x64342210
y.create.l HWIO_DBACK_PART1_INT_STATUS_ADDR A:0x64342214
y.create.l HWIO_DBACK_PART1_INT_CLR_ADDR A:0x64342218
y.create.l HWIO_DBACK_PART1_INT_EN_ADDR A:0x6434221c
y.create.l HWIO_DBACK_PART2_INT_STATUS_ADDR A:0x64342220
y.create.l HWIO_DBACK_PART2_INT_CLR_ADDR A:0x64342224
y.create.l HWIO_DBACK_PART2_INT_EN_ADDR A:0x64342228
y.create.l HWIO_DBACK_EAGCH_INT_EN_ADDR A:0x6434222c
y.create.l HWIO_DBACK_TEST_MEM_SEL_ADDR A:0x64342230
y.create.l HWIO_DBACK_TEST_BUS_SEL_ADDR A:0x64342234
y.create.l HWIO_DBACK_MEM_ADDR_ADDR A:0x64342238
y.create.l HWIO_DBACK_MEM_DATA0_ADDR A:0x6434223c
y.create.l HWIO_DBACK_MEM_DATA1_ADDR A:0x64342240
y.create.l HWIO_DBACK_MEM_DATA2_ADDR A:0x64342244
y.create.l HWIO_DBACK_MEM_DATA3_ADDR A:0x64342248
y.create.l HWIO_DBACK_MEM_DATA4_ADDR A:0x6434224c
y.create.l HWIO_T_DBACK_HS_CH0_DEC_DATA0_ADDR A:0x64342400
y.create.l HWIO_T_DBACK_HS_CH1_DEC_DATA0_ADDR A:0x6434240c
y.create.l HWIO_T_DBACK_HS_CH2_DEC_DATA0_ADDR A:0x64342418
y.create.l HWIO_T_DBACK_HS_CH3_DEC_DATA0_ADDR A:0x64342424
y.create.l HWIO_T_DBACK_HS_CH0_DEC_DATA1_ADDR A:0x64342404
y.create.l HWIO_T_DBACK_HS_CH1_DEC_DATA1_ADDR A:0x64342410
y.create.l HWIO_T_DBACK_HS_CH2_DEC_DATA1_ADDR A:0x6434241c
y.create.l HWIO_T_DBACK_HS_CH3_DEC_DATA1_ADDR A:0x64342428
y.create.l HWIO_T_DBACK_HS_CH0_DEC_STAT_ADDR A:0x64342408
y.create.l HWIO_T_DBACK_HS_CH1_DEC_STAT_ADDR A:0x64342414
y.create.l HWIO_T_DBACK_HS_CH2_DEC_STAT_ADDR A:0x64342420
y.create.l HWIO_T_DBACK_HS_CH3_DEC_STAT_ADDR A:0x6434242c
y.create.l HWIO_T_DBACK_EAGCH0_DEC_DATA0_ADDR A:0x64342430
y.create.l HWIO_T_DBACK_EAGCH1_DEC_DATA0_ADDR A:0x64342440
y.create.l HWIO_T_DBACK_EAGCH2_DEC_DATA0_ADDR A:0x64342450
y.create.l HWIO_T_DBACK_EAGCH3_DEC_DATA0_ADDR A:0x64342460
y.create.l HWIO_T_DBACK_EAGCH0_DEC_DATA1_ADDR A:0x64342434
y.create.l HWIO_T_DBACK_EAGCH1_DEC_DATA1_ADDR A:0x64342444
y.create.l HWIO_T_DBACK_EAGCH2_DEC_DATA1_ADDR A:0x64342454
y.create.l HWIO_T_DBACK_EAGCH3_DEC_DATA1_ADDR A:0x64342464
y.create.l HWIO_T_DBACK_EAGCH0_DEC_STAT_ADDR A:0x64342438
y.create.l HWIO_T_DBACK_EAGCH1_DEC_STAT_ADDR A:0x64342448
y.create.l HWIO_T_DBACK_EAGCH2_DEC_STAT_ADDR A:0x64342458
y.create.l HWIO_T_DBACK_EAGCH3_DEC_STAT_ADDR A:0x64342468
y.create.l HWIO_T_DBACK_EAGCH0_METRIC_ADDR A:0x6434243c
y.create.l HWIO_T_DBACK_EAGCH1_METRIC_ADDR A:0x6434244c
y.create.l HWIO_T_DBACK_EAGCH2_METRIC_ADDR A:0x6434245c
y.create.l HWIO_T_DBACK_EAGCH3_METRIC_ADDR A:0x6434246c
y.create.l HWIO_T_DBACK_FPACH_DEC_DATA0_ADDR A:0x64342470
y.create.l HWIO_T_DBACK_FPACH_DEC_DATA1_ADDR A:0x64342474
y.create.l HWIO_T_DBACK_FPACH_DEC_STAT_ADDR A:0x64342478
y.create.l HWIO_T_DBACK_TEST_MEM_SEL_ADDR A:0x6434247c
y.create.l HWIO_T_DBACK_TEST_BUS_SEL_ADDR A:0x64342480
y.create.l HWIO_T_DBACK_MEM_ADDR_ADDR A:0x64342484
y.create.l HWIO_T_DBACK_MEM_DATA0_ADDR A:0x64342488
y.create.l HWIO_T_DBACK_MEM_DATA1_ADDR A:0x6434248c
y.create.l HWIO_T_DBACK_MEM_DATA2_ADDR A:0x64342490
y.create.l HWIO_T_DBACK_MEM_DATA3_ADDR A:0x64342494
y.create.l HWIO_T_DBACK_MEM_DATA4_ADDR A:0x64342498
y.create.l HWIO_T_DBACK_HS_CH0_DC_DEC_DATA0_ADDR A:0x6434249c
y.create.l HWIO_T_DBACK_HS_CH1_DC_DEC_DATA0_ADDR A:0x643424a8
y.create.l HWIO_T_DBACK_HS_CH2_DC_DEC_DATA0_ADDR A:0x643424b4
y.create.l HWIO_T_DBACK_HS_CH3_DC_DEC_DATA0_ADDR A:0x643424c0
y.create.l HWIO_T_DBACK_HS_CH0_DC_DEC_DATA1_ADDR A:0x643424a0
y.create.l HWIO_T_DBACK_HS_CH1_DC_DEC_DATA1_ADDR A:0x643424ac
y.create.l HWIO_T_DBACK_HS_CH2_DC_DEC_DATA1_ADDR A:0x643424b8
y.create.l HWIO_T_DBACK_HS_CH3_DC_DEC_DATA1_ADDR A:0x643424c4
y.create.l HWIO_T_DBACK_HS_CH0_DC_DEC_STAT_ADDR A:0x643424a4
y.create.l HWIO_T_DBACK_HS_CH1_DC_DEC_STAT_ADDR A:0x643424b0
y.create.l HWIO_T_DBACK_HS_CH2_DC_DEC_STAT_ADDR A:0x643424bc
y.create.l HWIO_T_DBACK_HS_CH3_DC_DEC_STAT_ADDR A:0x643424c8
y.create.l HWIO_DINT_CFG_ADDR A:0x64342600
y.create.l HWIO_DINT_CH0_CFG_ADDR A:0x64342604
y.create.l HWIO_DINT_CH1_CFG_ADDR A:0x64342608
y.create.l HWIO_DINT_CH2_CFG_ADDR A:0x6434260c
y.create.l HWIO_TD_BLOCK_SIZE_ADDR A:0x64342614
y.create.l HWIO_TD_INTLV_CFG_LO_ADDR A:0x64342618
y.create.l HWIO_TD_INTLV_CFG_HI_ADDR A:0x6434261c
y.create.l HWIO_TD_INTLV_SIZE_LO_ADDR A:0x64342620
y.create.l HWIO_TD_PUNCT_LO_ADDR A:0x64342624
y.create.l HWIO_TD_PUNCT_HI_ADDR A:0x64342628
y.create.l HWIO_DINT_PKT_OFFSET_ADDR A:0x64342630
y.create.l HWIO_DINT_PKT_CFG_ADDR A:0x64342634
y.create.l HWIO_DINT_TASK_OFFSET_ADDR A:0x64342638
y.create.l HWIO_DINT_TASK_LIST_ADDR A:0x6434263c
y.create.l HWIO_TST_SYNC_DINT_ADDR A:0x64342640
y.create.l HWIO_TST_CH0_SYMS_ADDR A:0x64342644
y.create.l HWIO_TST_CH1_SYMS_ADDR A:0x64342648
y.create.l HWIO_TST_CH2_SYMS_ADDR A:0x6434264c
y.create.l HWIO_TST_SEL_DINT_ADDR A:0x64342654
y.create.l HWIO_DINT_OTD_CFG_ADDR A:0x64342658
y.create.l HWIO_TST_SYS_TIME_ADDR A:0x64342670
y.create.l HWIO_DEINT_DBG_BUS_CTL_ADDR A:0x64342674
y.create.l HWIO_DEC_CLR_INT_STATUS_ADDR A:0x64342684
y.create.l HWIO_DEINT_CLK_STATUS_ADDR A:0x64342688
y.create.l HWIO_DEC_DONE_INT_STATUS_ADDR A:0x6434268c
y.create.l HWIO_DEINT_TASK_STATUS_ADDR A:0x64342690
y.create.l HWIO_DEINT_FRMHYP_STATUS_ADDR A:0x64342694
y.create.l HWIO_DINT_VD_RD_ADDR_ADDR A:0x64342698
y.create.l HWIO_DINT_FCH_CFG0_ADDR A:0x6434269c
y.create.l HWIO_DINT_FCH_CFG1_ADDR A:0x643426a0
y.create.l HWIO_DINT_FCH_TRIGGER_ADDR A:0x643426a4
y.create.l HWIO_DINT_FCH_WR_BANK_ADDR A:0x643426a8
y.create.l HWIO_DINT_FCH_EGTH_HYP_CFG0_ADDR A:0x643426ac
y.create.l HWIO_DINT_FCH_EGTH_HYP_CFG1_ADDR A:0x643426b0
y.create.l HWIO_DINT_FCH_EGTH_HYP_CFG2_ADDR A:0x643426b4
y.create.l HWIO_DINT_FCH_EGTH_HYP_CFG3_ADDR A:0x643426b8
y.create.l HWIO_DINT_FCH_QRTR_HYP_CFG0_ADDR A:0x643426bc
y.create.l HWIO_DINT_FCH_QRTR_HYP_CFG1_ADDR A:0x643426c0
y.create.l HWIO_DINT_FCH_QRTR_HYP_CFG2_ADDR A:0x643426c4
y.create.l HWIO_DINT_FCH_QRTR_HYP_CFG3_ADDR A:0x643426c8
y.create.l HWIO_DINT_FCH_HALF_HYP_CFG0_ADDR A:0x643426cc
y.create.l HWIO_DINT_FCH_HALF_HYP_CFG1_ADDR A:0x643426d0
y.create.l HWIO_DINT_FCH_HALF_HYP_CFG2_ADDR A:0x643426d4
y.create.l HWIO_DINT_FCH_HALF_HYP_CFG3_ADDR A:0x643426d8
y.create.l HWIO_DINT_FCH_FULL_HYP_CFG0_ADDR A:0x643426dc
y.create.l HWIO_DINT_FCH_FULL_HYP_CFG1_ADDR A:0x643426e0
y.create.l HWIO_DINT_FCH_FULL_HYP_CFG2_ADDR A:0x643426e4
y.create.l HWIO_DINT_FCH_FULL_HYP_CFG3_ADDR A:0x643426e8
y.create.l HWIO_COMB_FUND_SOFT_DEC_IQ_WR_ADDR A:0x64342900
y.create.l HWIO_C_SYNC_TRIG_REG_ADDR A:0x64342904
y.create.l HWIO_CH0_Q_SOFTDEC_ENABLE_ADDR A:0x64342908
y.create.l HWIO_CH1_CONTROL_ADDR A:0x6434290c
y.create.l HWIO_CH2_CONTROL_ADDR A:0x64342910
y.create.l HWIO_CDMA_WIDGET_STATUS0_ADDR A:0x64342914
y.create.l HWIO_RESET_STATUS0_ADDR A:0x64342918
y.create.l HWIO_CDMA_WIDGET_STATUS1_ADDR A:0x6434291c
y.create.l HWIO_RESET_STATUS1_ADDR A:0x64342920
y.create.l HWIO_HDR_DINT_STATUS_ADDR A:0x64342c24
y.create.l HWIO_HDR_DINT_DBG_BUS_ADDR A:0x64342c80
y.create.l HWIO_HDR_DINT_CLK_STATUS_ADDR A:0x64342c84
y.create.l HWIO_DEMBACK_BUFF_MODE_ADDR A:0x64344004
y.create.l HWIO_DEMBACK_AHB_MEM_PAGE_ADDR A:0x64344008
y.create.l HWIO_DEMBACK_BUFF_MEM_CMD_ADDR A:0x64344010
y.create.l HWIO_DEMBACK_BUFF_MEM_WR_ADDR A:0x64344014
y.create.l HWIO_DEMBACK_BUFF_MEM_RD_ADDR A:0x64344018
y.create.l HWIO_DEMBACK_DBBUF_RDR0_CFG0_ADDR A:0x64344020
y.create.l HWIO_DEMBACK_DBBUF_RDR1_CFG0_ADDR A:0x6434402c
y.create.l HWIO_DEMBACK_DBBUF_RDR2_CFG0_ADDR A:0x64344038
y.create.l HWIO_DEMBACK_DBBUF_RDR3_CFG0_ADDR A:0x64344044
y.create.l HWIO_DEMBACK_DBBUF_RDR0_CFG1_ADDR A:0x64344024
y.create.l HWIO_DEMBACK_DBBUF_RDR1_CFG1_ADDR A:0x64344030
y.create.l HWIO_DEMBACK_DBBUF_RDR2_CFG1_ADDR A:0x6434403c
y.create.l HWIO_DEMBACK_DBBUF_RDR3_CFG1_ADDR A:0x64344048
y.create.l HWIO_DEMBACK_DBBUF_RDR0_XFER_CTL_ADDR A:0x64344028
y.create.l HWIO_DEMBACK_DBBUF_RDR1_XFER_CTL_ADDR A:0x64344034
y.create.l HWIO_DEMBACK_DBBUF_RDR2_XFER_CTL_ADDR A:0x64344040
y.create.l HWIO_DEMBACK_DBBUF_RDR3_XFER_CTL_ADDR A:0x6434404c
y.create.l HWIO_DEMBACK_DBBUF_WRTR0_CFG0_ADDR A:0x64344080
y.create.l HWIO_DEMBACK_DBBUF_WRTR1_CFG0_ADDR A:0x6434408c
y.create.l HWIO_DEMBACK_DBBUF_WRTR2_CFG0_ADDR A:0x64344098
y.create.l HWIO_DEMBACK_DBBUF_WRTR3_CFG0_ADDR A:0x643440a4
y.create.l HWIO_DEMBACK_DBBUF_WRTR0_CFG1_ADDR A:0x64344084
y.create.l HWIO_DEMBACK_DBBUF_WRTR1_CFG1_ADDR A:0x64344090
y.create.l HWIO_DEMBACK_DBBUF_WRTR2_CFG1_ADDR A:0x6434409c
y.create.l HWIO_DEMBACK_DBBUF_WRTR3_CFG1_ADDR A:0x643440a8
y.create.l HWIO_DEMBACK_DBBUF_WRTR0_XFER_CTL_ADDR A:0x64344088
y.create.l HWIO_DEMBACK_DBBUF_WRTR1_XFER_CTL_ADDR A:0x64344094
y.create.l HWIO_DEMBACK_DBBUF_WRTR2_XFER_CTL_ADDR A:0x643440a0
y.create.l HWIO_DEMBACK_DBBUF_WRTR3_XFER_CTL_ADDR A:0x643440ac
y.create.l HWIO_DEMBACK_DBBUF_BRDG_CTL_ADDR A:0x64344100
y.create.l HWIO_DEMBACK_DBBUF_BRDG_STATUS_ADDR A:0x64344104
y.create.l HWIO_DEMBACK_DBBUF_BRDG_CLEAR_ADDR A:0x64344108
y.create.l HWIO_DEMBACK_BUFF_TBVD_DECOB_RD_MIN_ADDR A:0x64345000
y.create.l HWIO_DEMBACK_BUFF_TBVD_DECOB_RD_MAX_ADDR A:0x6434577c
y.create.l HWIO_DEMBACK_BUFF_SVD_DECOB_RD_MIN_ADDR A:0x64346000
y.create.l HWIO_DEMBACK_BUFF_SVD_DECOB_RD_MAX_ADDR A:0x64346d7c
y.create.l HWIO_SVD_TBVD_CLK_STATUS_REG_ADDR A:0x64348000
y.create.l HWIO_SVD_TBVD_HW_IDLE_ADDR A:0x64348004
y.create.l HWIO_SVD_TBVD_TESTBUS_ENABLE_ADDR A:0x64348008
y.create.l HWIO_SVD_MODE_ADDR A:0x6434800c
y.create.l HWIO_SVD_POLY2IJ_ADDR A:0x64348010
y.create.l HWIO_SVD_POLY3IJ_ADDR A:0x64348014
y.create.l HWIO_SVD_POLY3K_ADDR A:0x64348018
y.create.l HWIO_SVD_POLY4IJ_ADDR A:0x6434801c
y.create.l HWIO_SVD_POLY4KL_ADDR A:0x64348020
y.create.l HWIO_SVD_TESTCON_ADDR A:0x64348024
y.create.l HWIO_SVD_TESTOUT_ADDR A:0x64348028
y.create.l HWIO_SVD_TEST_MEM_SEL_ADDR A:0x6434802c
y.create.l HWIO_SVD_TEST_MEM_ADDR_ADDR A:0x64348030
y.create.l HWIO_SVD_TEST_MEM_WRITE_ADDR A:0x64348034
y.create.l HWIO_SVD_TEST_MEM_READ0_ADDR A:0x64348038
y.create.l HWIO_SVD_TEST_MEM_READ1_ADDR A:0x6434803c
y.create.l HWIO_SVD_TEST_MEM_DIN_ADDR A:0x64348040
y.create.l HWIO_TBVD_DEBUG_MEM_CMD_ADDR A:0x64348044
y.create.l HWIO_TBVD_DEBUG_MEM_WR_ADDR A:0x64348048
y.create.l HWIO_TBVD_DEBUG_MEM_RD_ADDR A:0x6434804c
y.create.l HWIO_LTE_DEMBACK_SCH_STATUS_WORD0_ADDR A:0x64349000
y.create.l HWIO_LTE_DEMBACK_SCH_SHARED_WORD0_ADDR A:0x64349100
y.create.l HWIO_LTE_DEMBACK_SCH_SHARED_WORD1_ADDR A:0x64349104
y.create.l HWIO_LTE_DEMBACK_SCH_SHARED_WORD2_ADDR A:0x64349108
y.create.l HWIO_LTE_DEMBACK_SCH_SHARED_WORD3_ADDR A:0x6434910c
y.create.l HWIO_LTE_DEMBACK_SCH_SHARED_WORD4_ADDR A:0x64349110
y.create.l HWIO_LTE_DEMBACK_SCH_SHARED_WORD5_ADDR A:0x64349114
y.create.l HWIO_PDSCH_HARQ_CFG_WORD0_ADDR A:0x64349200
y.create.l HWIO_PDSCH_HARQ_CFG_WORD1_ADDR A:0x64349204
y.create.l HWIO_PDSCH_HARQ_CFG_WORD2_ADDR A:0x64349208
y.create.l HWIO_PDSCH_HARQ_CFG_WORD3_ADDR A:0x6434920c
y.create.l HWIO_PDSCH_HARQ_CFG_WORD4_ADDR A:0x64349210
y.create.l HWIO_PDSCH_HARQ_CFG_WORD5_ADDR A:0x64349214
y.create.l HWIO_PDSCH_HARQ_CFG_WORD6_ADDR A:0x64349218
y.create.l HWIO_PDSCH_HARQ_CFG_WORD7_ADDR A:0x6434921c
y.create.l HWIO_PDSCH_HARQ_CFG_WORD8_ADDR A:0x64349220
y.create.l HWIO_LTE_DEMBACK_CCH_STATUS_WORD0_ADDR A:0x6434a000
y.create.l HWIO_LTE_DEMBACK_CCH_SHARED_WORD0_ADDR A:0x6434a100
y.create.l HWIO_LTE_DEMBACK_CCH_SHARED_WORD1_ADDR A:0x6434a104
y.create.l HWIO_LTE_DEMBACK_CCH_SHARED_WORD2_ADDR A:0x6434a108
y.create.l HWIO_LTE_DEMBACK_CCH_SHARED_WORD3_ADDR A:0x6434a10c
y.create.l HWIO_LTE_DEMBACK_CCH_SHARED_WORD4_ADDR A:0x6434a110
y.create.l HWIO_LTE_DEMBACK_CCH_SHARED_WORD5_ADDR A:0x6434a114
y.create.l HWIO_LTE_DEMBACK_CCH_SHARED_WORD6_ADDR A:0x6434a118
y.create.l HWIO_LTE_DEMBACK_CCH_SHARED_WORD7_ADDR A:0x6434a11c
y.create.l HWIO_PDCCH_DEINT_CFG_WORD0_ADDR A:0x6434a200
y.create.l HWIO_PDCCH_DEINT_CFG_WORD1_ADDR A:0x6434a204
y.create.l HWIO_PDCCH_DEINT_CFG_WORD2_ADDR A:0x6434a208
y.create.l HWIO_SYMBOL0_REG_MAP_0_WORD0_ADDR A:0x6434a300
y.create.l HWIO_SYMBOL0_REG_MAP_0_WORD1_ADDR A:0x6434a304
y.create.l HWIO_SYMBOL0_REG_MAP_0_WORD2_ADDR A:0x6434a308
y.create.l HWIO_SYMBOL0_REG_MAP_0_WORD3_ADDR A:0x6434a30c
y.create.l HWIO_SYMBOL0_REG_MAP_0_WORD4_ADDR A:0x6434a310
y.create.l HWIO_SYMBOL0_REG_MAP_0_WORD5_ADDR A:0x6434a314
y.create.l HWIO_SYMBOL0_REG_MAP_0_WORD6_ADDR A:0x6434a318
y.create.l HWIO_SYMBOL0_REG_MAP_0_WORD7_ADDR A:0x6434a31c
y.create.l HWIO_SYMBOL0_REG_MAP_1_WORD0_ADDR A:0x6434a400
y.create.l HWIO_SYMBOL0_REG_MAP_1_WORD1_ADDR A:0x6434a404
y.create.l HWIO_SYMBOL0_REG_MAP_1_WORD2_ADDR A:0x6434a408
y.create.l HWIO_SYMBOL0_REG_MAP_1_WORD3_ADDR A:0x6434a40c
y.create.l HWIO_SYMBOL0_REG_MAP_1_WORD4_ADDR A:0x6434a410
y.create.l HWIO_SYMBOL0_REG_MAP_1_WORD5_ADDR A:0x6434a414
y.create.l HWIO_SYMBOL0_REG_MAP_1_WORD6_ADDR A:0x6434a418
y.create.l HWIO_SYMBOL0_REG_MAP_1_WORD7_ADDR A:0x6434a41c
y.create.l HWIO_SYMBOL0_REG_MAP_2_WORD0_ADDR A:0x6434a500
y.create.l HWIO_SYMBOL0_REG_MAP_2_WORD1_ADDR A:0x6434a504
y.create.l HWIO_SYMBOL0_REG_MAP_2_WORD2_ADDR A:0x6434a508
y.create.l HWIO_SYMBOL0_REG_MAP_2_WORD3_ADDR A:0x6434a50c
y.create.l HWIO_SYMBOL0_REG_MAP_2_WORD4_ADDR A:0x6434a510
y.create.l HWIO_SYMBOL0_REG_MAP_2_WORD5_ADDR A:0x6434a514
y.create.l HWIO_SYMBOL0_REG_MAP_2_WORD6_ADDR A:0x6434a518
y.create.l HWIO_SYMBOL0_REG_MAP_2_WORD7_ADDR A:0x6434a51c
y.create.l HWIO_SYMBOL1_REG_MAP_0_WORD0_ADDR A:0x6434a600
y.create.l HWIO_SYMBOL1_REG_MAP_0_WORD1_ADDR A:0x6434a604
y.create.l HWIO_SYMBOL1_REG_MAP_0_WORD2_ADDR A:0x6434a608
y.create.l HWIO_SYMBOL1_REG_MAP_0_WORD3_ADDR A:0x6434a60c
y.create.l HWIO_SYMBOL1_REG_MAP_0_WORD4_ADDR A:0x6434a610
y.create.l HWIO_SYMBOL1_REG_MAP_0_WORD5_ADDR A:0x6434a614
y.create.l HWIO_SYMBOL1_REG_MAP_0_WORD6_ADDR A:0x6434a618
y.create.l HWIO_SYMBOL1_REG_MAP_0_WORD7_ADDR A:0x6434a61c
y.create.l HWIO_SYMBOL1_REG_MAP_0_WORD8_ADDR A:0x6434a620
y.create.l HWIO_SYMBOL1_REG_MAP_0_WORD9_ADDR A:0x6434a624
y.create.l HWIO_SYMBOL1_REG_MAP_0_WORD10_ADDR A:0x6434a628
y.create.l HWIO_SYMBOL1_REG_MAP_1_WORD0_ADDR A:0x6434a700
y.create.l HWIO_SYMBOL1_REG_MAP_1_WORD1_ADDR A:0x6434a704
y.create.l HWIO_SYMBOL1_REG_MAP_1_WORD2_ADDR A:0x6434a708
y.create.l HWIO_SYMBOL1_REG_MAP_1_WORD3_ADDR A:0x6434a70c
y.create.l HWIO_SYMBOL1_REG_MAP_1_WORD4_ADDR A:0x6434a710
y.create.l HWIO_SYMBOL1_REG_MAP_1_WORD5_ADDR A:0x6434a714
y.create.l HWIO_SYMBOL1_REG_MAP_1_WORD6_ADDR A:0x6434a718
y.create.l HWIO_SYMBOL1_REG_MAP_1_WORD7_ADDR A:0x6434a71c
y.create.l HWIO_SYMBOL1_REG_MAP_1_WORD8_ADDR A:0x6434a720
y.create.l HWIO_SYMBOL1_REG_MAP_1_WORD9_ADDR A:0x6434a724
y.create.l HWIO_SYMBOL1_REG_MAP_1_WORD10_ADDR A:0x6434a728
y.create.l HWIO_SYMBOL2_REG_MAP_WORD0_ADDR A:0x6434a800
y.create.l HWIO_SYMBOL2_REG_MAP_WORD1_ADDR A:0x6434a804
y.create.l HWIO_SYMBOL2_REG_MAP_WORD2_ADDR A:0x6434a808
y.create.l HWIO_SYMBOL2_REG_MAP_WORD3_ADDR A:0x6434a80c
y.create.l HWIO_SYMBOL2_REG_MAP_WORD4_ADDR A:0x6434a810
y.create.l HWIO_SYMBOL2_REG_MAP_WORD5_ADDR A:0x6434a814
y.create.l HWIO_SYMBOL2_REG_MAP_WORD6_ADDR A:0x6434a818
y.create.l HWIO_SYMBOL2_REG_MAP_WORD7_ADDR A:0x6434a81c
y.create.l HWIO_SYMBOL2_REG_MAP_WORD8_ADDR A:0x6434a820
y.create.l HWIO_SYMBOL2_REG_MAP_WORD9_ADDR A:0x6434a824
y.create.l HWIO_SYMBOL2_REG_MAP_WORD10_ADDR A:0x6434a828
y.create.l HWIO_PBCH_DEINT_CFG_WORD0_ADDR A:0x6434a900
y.create.l HWIO_PBCH_DEINT_CFG_WORD1_ADDR A:0x6434a904
y.create.l HWIO_PBCH_DEINT_CFG_WORD2_ADDR A:0x6434a908
y.create.l HWIO_PBCH_DEINT_CFG_WORD3_ADDR A:0x6434a90c
y.create.l HWIO_PBCH_DEINT_CFG_WORD4_ADDR A:0x6434a910
y.create.l HWIO_PBCH_DEINT_CFG_WORD5_ADDR A:0x6434a914
y.create.l HWIO_PBCH_DEINT_CFG_WORD6_ADDR A:0x6434a918
y.create.l HWIO_PBCH_DEINT_CFG_WORD7_ADDR A:0x6434a91c
y.create.l HWIO_PBCH_DEINT_CFG_WORD8_ADDR A:0x6434a920
y.create.l HWIO_PBCH_DEINT_CFG_WORD9_ADDR A:0x6434a924
y.create.l HWIO_PBCH_DEINT_CFG_WORD10_ADDR A:0x6434a928
y.create.l HWIO_PDCCH_REG_REORDER_WORD0_ADDR A:0x6434aa00
y.create.l HWIO_PDCCH_REG_REORDER_WORD1_ADDR A:0x6434aa04
y.create.l HWIO_PDCCH_REG_REORDER_WORD2_ADDR A:0x6434aa08
y.create.l HWIO_PDCCH_REG_REORDER_WORD3_ADDR A:0x6434aa0c
y.create.l HWIO_PDCCH_REG_REORDER_WORD4_ADDR A:0x6434aa10
y.create.l HWIO_PBCH_FOH_WORD0_ADDR A:0x6434ab00
y.create.l HWIO_PBCH_FOH_WORD1_ADDR A:0x6434ab04
y.create.l HWIO_PBCH_FOH_WORD2_ADDR A:0x6434ab08
y.create.l HWIO_PDSCH_REENC_TB_CFG_WORD0_ADDR A:0x6434b100
y.create.l HWIO_PDSCH_REENC_TB_CFG_WORD1_ADDR A:0x6434b104
y.create.l HWIO_PDSCH_REENC_TB_CFG_WORD2_ADDR A:0x6434b108
y.create.l HWIO_PDSCH_REENC_CB_WORD0_ADDR A:0x6434b200
y.create.l HWIO_PDSCH_REENC_CB_WORD1_ADDR A:0x6434b204
y.create.l HWIO_PDSCH_REENC_CB_WORD2_ADDR A:0x6434b208
y.create.l HWIO_PBCH_REENC_WORD0_ADDR A:0x6434b300
y.create.l HWIO_PBCH_REENC_WORD1_ADDR A:0x6434b304
y.create.l HWIO_PBCH_REENC_WORD2_ADDR A:0x6434b308
y.create.l HWIO_W_DBACK_HS_SHARED_WORD0_ADDR A:0x6434c100
y.create.l HWIO_W_DBACK_HS_SHARED_WORD1_ADDR A:0x6434c104
y.create.l HWIO_W_DBACK_HS_SHARED_WORD2_ADDR A:0x6434c108
y.create.l HWIO_W_DBACK_HS_SHARED_WORD3_ADDR A:0x6434c10c
y.create.l HWIO_W_DBACK_HS_SHARED_WORD4_ADDR A:0x6434c110
y.create.l HWIO_W_DBACK_HS_SHARED_WORD5_ADDR A:0x6434c114
y.create.l HWIO_W_DBACK_HS_SHARED_WORD6_ADDR A:0x6434c118
y.create.l HWIO_W_DBACK_HS_SHARED_WORD7_ADDR A:0x6434c11c
y.create.l HWIO_W_DBACK_HS_SHARED_WORD8_ADDR A:0x6434c120
y.create.l HWIO_W_DBACK_HS_SHARED_WORD9_ADDR A:0x6434c124
y.create.l HWIO_W_DBACK_HS_SHARED_WORD10_ADDR A:0x6434c128
y.create.l HWIO_W_DBACK_HS_SHARED_WORD11_ADDR A:0x6434c12c
y.create.l HWIO_W_DBACK_HS_SHARED_WORD12_ADDR A:0x6434c130
y.create.l HWIO_W_DBACK_HS_SHARED_WORD13_ADDR A:0x6434c134
y.create.l HWIO_W_DBACK_HS_SHARED_WORD14_ADDR A:0x6434c138
y.create.l HWIO_W_DBACK_HS_SHARED_WORD15_ADDR A:0x6434c13c
y.create.l HWIO_W_DBACK_HS_SHARED_WORD16_ADDR A:0x6434c140
y.create.l HWIO_W_DBACK_HS_SHARED_WORD17_ADDR A:0x6434c144
y.create.l HWIO_W_DBACK_HS_SHARED_WORD18_ADDR A:0x6434c148
y.create.l HWIO_W_DBACK_HS_SHARED_WORD19_ADDR A:0x6434c14c
y.create.l HWIO_W_DBACK_HS_SHARED_WORD20_ADDR A:0x6434c150
y.create.l HWIO_W_DBACK_HS_SHARED_WORD21_ADDR A:0x6434c154
y.create.l HWIO_W_DBACK_HS_SHARED_WORD22_ADDR A:0x6434c158
y.create.l HWIO_W_DBACK_HS_SHARED_WORD23_ADDR A:0x6434c15c
y.create.l HWIO_W_DBACK_HS_SHARED_WORD24_ADDR A:0x6434c160
y.create.l HWIO_W_DBACK_HS_SHARED_WORD25_ADDR A:0x6434c164
y.create.l HWIO_W_DBACK_HS_SHARED_WORD26_ADDR A:0x6434c168
y.create.l HWIO_W_DBACK_HS_SHARED_WORD27_ADDR A:0x6434c16c
y.create.l HWIO_W_DBACK_HS_SHARED_WORD28_ADDR A:0x6434c170
y.create.l HWIO_W_DBACK_HS_SHARED_WORD29_ADDR A:0x6434c174
y.create.l HWIO_W_DBACK_HS_SHARED_WORD30_ADDR A:0x6434c178
y.create.l HWIO_W_DBACK_HS_SHARED_WORD31_ADDR A:0x6434c17c
y.create.l HWIO_W_DBACK_HS_SHARED_WORD32_ADDR A:0x6434c180
y.create.l HWIO_W_DBACK_HS_SHARED_WORD33_ADDR A:0x6434c184
y.create.l HWIO_W_DBACK_HS_SHARED_WORD34_ADDR A:0x6434c188
y.create.l HWIO_W_DBACK_HS_SHARED_WORD35_ADDR A:0x6434c18c
y.create.l HWIO_W_DBACK_HS_SHARED_WORD36_ADDR A:0x6434c190
y.create.l HWIO_W_DBACK_HS_SHARED_WORD37_ADDR A:0x6434c194
y.create.l HWIO_W_DBACK_HS_SHARED_WORD38_ADDR A:0x6434c198
y.create.l HWIO_W_DBACK_HS_SHARED_WORD39_ADDR A:0x6434c19c
y.create.l HWIO_W_DBACK_HS_SHARED_WORD40_ADDR A:0x6434c1a0
y.create.l HWIO_W_DBACK_HS_SHARED_WORD41_ADDR A:0x6434c1a4
y.create.l HWIO_W_DBACK_HS_SHARED_WORD42_ADDR A:0x6434c1a8
y.create.l HWIO_W_DBACK_HS_SHARED_WORD43_ADDR A:0x6434c1ac
y.create.l HWIO_W_DBACK_HS_SHARED_WORD44_ADDR A:0x6434c1b0
y.create.l HWIO_W_DBACK_HS_SHARED_WORD45_ADDR A:0x6434c1b4
y.create.l HWIO_W_DBACK_HS_SHARED_WORD46_ADDR A:0x6434c1b8
y.create.l HWIO_W_DBACK_HS_SHARED_WORD47_ADDR A:0x6434c1bc
y.create.l HWIO_W_DBACK_HS_SHARED_WORD48_ADDR A:0x6434c1c0
y.create.l HWIO_W_DBACK_HS_SHARED_WORD49_ADDR A:0x6434c1c4
y.create.l HWIO_W_DBACK_HS_SHARED_WORD50_ADDR A:0x6434c1c8
y.create.l HWIO_W_DBACK_HS_SHARED_WORD51_ADDR A:0x6434c1cc
y.create.l HWIO_W_DBACK_HS_SHARED_WORD52_ADDR A:0x6434c1d0
y.create.l HWIO_W_DBACK_HS_SHARED_WORD53_ADDR A:0x6434c1d4
y.create.l HWIO_W_DBACK_HS_SHARED_WORD54_ADDR A:0x6434c1d8
y.create.l HWIO_W_DBACK_HS_SHARED_WORD55_ADDR A:0x6434c1dc
y.create.l HWIO_W_DBACK_HS_SHARED_WORD56_ADDR A:0x6434c1e0
y.create.l HWIO_W_DBACK_HS_SHARED_WORD57_ADDR A:0x6434c1e4
y.create.l HWIO_W_DBACK_HS_TD_DECIB_WRITER_WORD0_ADDR A:0x6434c200
y.create.l HWIO_W_DBACK_HS_TD_DECIB_WRITER_CFG_WORD0_ADDR A:0x6434c300
y.create.l HWIO_W_DBACK_HS_TD_DECIB_WRITER_CFG_WORD1_ADDR A:0x6434c304
y.create.l HWIO_W_DBACK_HS_TD_DECIB_WRITER_CFG_WORD2_ADDR A:0x6434c308
y.create.l HWIO_W_DBACK_HS_TD_DECIB_WRITER_CFG_WORD3_ADDR A:0x6434c30c
y.create.l HWIO_W_DBACK_HS_TD_DECIB_WRITER_CFG_WORD4_ADDR A:0x6434c310
y.create.l HWIO_W_DBACK_HS_TD_DECIB_WRITER_CFG_WORD5_ADDR A:0x6434c314
y.create.l HWIO_W_DBACK_HS_TD_DECIB_WRITER_CFG_WORD6_ADDR A:0x6434c318
y.create.l HWIO_W_DBACK_HS_TD_DECIB_WRITER_CFG_WORD7_ADDR A:0x6434c31c
y.create.l HWIO_W_DBACK_NONHS_SHARED_WORD0_ADDR A:0x6434d100
y.create.l HWIO_W_DBACK_NONHS_SHARED_WORD1_ADDR A:0x6434d104
y.create.l HWIO_W_DBACK_NONHS_SHARED_WORD2_ADDR A:0x6434d108
y.create.l HWIO_W_DBACK_NONHS_SHARED_WORD3_ADDR A:0x6434d10c
y.create.l HWIO_W_DBACK_NONHS_SHARED_WORD4_ADDR A:0x6434d110
y.create.l HWIO_W_DBACK_NONHS_SHARED_WORD5_ADDR A:0x6434d114
y.create.l HWIO_W_DBACK_NONHS_SHARED_WORD6_ADDR A:0x6434d118
y.create.l HWIO_W_DBACK_NONHS_SHARED_WORD7_ADDR A:0x6434d11c
y.create.l HWIO_W_DBACK_NONHS_DRM_CFG_WORD0_ADDR A:0x6434d200
y.create.l HWIO_W_DBACK_NONHS_DRM_CFG_WORD1_ADDR A:0x6434d204
y.create.l HWIO_W_DBACK_NONHS_DRM_CFG_WORD2_ADDR A:0x6434d208
y.create.l HWIO_W_DBACK_NONHS_DRM_CFG_WORD3_ADDR A:0x6434d20c
y.create.l HWIO_W_DBACK_NONHS_DRM_CFG_WORD4_ADDR A:0x6434d210
y.create.l HWIO_W_DBACK_NONHS_DRM_CFG_WORD5_ADDR A:0x6434d214
y.create.l HWIO_W_DBACK_NONHS_DRM_CFG_WORD6_ADDR A:0x6434d218
y.create.l HWIO_W_DBACK_NONHS_DRM_CFG_WORD7_ADDR A:0x6434d21c
y.create.l HWIO_W_DBACK_NONHS_DRM_CFG_WORD8_ADDR A:0x6434d220
y.create.l HWIO_W_DBACK_NONHS_DRM_CFG_WORD9_ADDR A:0x6434d224
y.create.l HWIO_W_DBACK_NONHS_DRM_CFG_WORD10_ADDR A:0x6434d228
y.create.l HWIO_W_DBACK_NONHS_DRM_CFG_WORD11_ADDR A:0x6434d22c
y.create.l HWIO_W_DBACK_NONHS_DRM_CFG_WORD12_ADDR A:0x6434d230
y.create.l HWIO_W_DBACK_NONHS_DRM_CFG_WORD13_ADDR A:0x6434d234
y.create.l HWIO_W_DBACK_NONHS_DRM_CFG_WORD14_ADDR A:0x6434d238
y.create.l HWIO_W_DBACK_NONHS_DRM_CFG_WORD15_ADDR A:0x6434d23c
y.create.l HWIO_W_DBACK_NONHS_TD_DECIB_WRITER_CFG_WORD0_ADDR A:0x6434d300
y.create.l HWIO_W_DBACK_NONHS_TD_DECIB_WRITER_CFG_WORD1_ADDR A:0x6434d304
y.create.l HWIO_T_DBACK_SHARED_WORD0_ADDR A:0x6434e100
y.create.l HWIO_T_DBACK_SHARED_WORD1_ADDR A:0x6434e104
y.create.l HWIO_T_DBACK_SHARED_WORD2_ADDR A:0x6434e108
y.create.l HWIO_T_DBACK_SHARED_WORD3_ADDR A:0x6434e10c
y.create.l HWIO_T_DBACK_SHARED_WORD4_ADDR A:0x6434e110
y.create.l HWIO_T_DBACK_SHARED_WORD5_ADDR A:0x6434e114
y.create.l HWIO_T_DBACK_SHARED_WORD6_ADDR A:0x6434e118
y.create.l HWIO_T_DBACK_SHARED_WORD7_ADDR A:0x6434e11c
y.create.l HWIO_T_DBACK_SHARED_WORD8_ADDR A:0x6434e120
y.create.l HWIO_T_DBACK_SHARED_WORD9_ADDR A:0x6434e124
y.create.l HWIO_T_DBACK_SHARED_WORD10_ADDR A:0x6434e128
y.create.l HWIO_T_DBACK_SHARED_WORD11_ADDR A:0x6434e12c
y.create.l HWIO_T_DBACK_SHARED_WORD12_ADDR A:0x6434e130
y.create.l HWIO_T_DBACK_SHARED_WORD13_ADDR A:0x6434e134
y.create.l HWIO_T_DBACK_SHARED_WORD14_ADDR A:0x6434e138
y.create.l HWIO_T_DBACK_SHARED_WORD15_ADDR A:0x6434e13c
y.create.l HWIO_T_DBACK_SHARED_WORD16_ADDR A:0x6434e140
y.create.l HWIO_T_DBACK_SHARED_WORD17_ADDR A:0x6434e144
y.create.l HWIO_T_DBACK_SHARED_WORD18_ADDR A:0x6434e148
y.create.l HWIO_T_DBACK_SHARED_WORD19_ADDR A:0x6434e14c
y.create.l HWIO_T_DBACK_SHARED_WORD20_ADDR A:0x6434e150
y.create.l HWIO_T_DBACK_SHARED_WORD21_ADDR A:0x6434e154
y.create.l HWIO_T_DBACK_SHARED_WORD22_ADDR A:0x6434e158
y.create.l HWIO_T_DBACK_SHARED_WORD23_ADDR A:0x6434e15c
y.create.l HWIO_T_DBACK_SHARED_WORD24_ADDR A:0x6434e160
y.create.l HWIO_T_DBACK_SHARED_WORD25_ADDR A:0x6434e164
y.create.l HWIO_T_DBACK_SHARED_WORD26_ADDR A:0x6434e168
y.create.l HWIO_T_DBACK_SHARED_WORD27_ADDR A:0x6434e16c
y.create.l HWIO_T_DBACK_SHARED_WORD28_ADDR A:0x6434e170
y.create.l HWIO_T_DBACK_SHARED_WORD29_ADDR A:0x6434e174
y.create.l HWIO_T_DBACK_SHARED_WORD30_ADDR A:0x6434e178
y.create.l HWIO_T_DBACK_SHARED_WORD31_ADDR A:0x6434e17c
y.create.l HWIO_T_DBACK_SHARED_WORD32_ADDR A:0x6434e180
y.create.l HWIO_T_DBACK_SHARED_WORD33_ADDR A:0x6434e184
y.create.l HWIO_T_DBACK_SHARED_WORD34_ADDR A:0x6434e188
y.create.l HWIO_T_DBACK_SHARED_WORD35_ADDR A:0x6434e18c
y.create.l HWIO_T_DBACK_SHARED_WORD36_ADDR A:0x6434e190
y.create.l HWIO_T_DBACK_SHARED_WORD37_ADDR A:0x6434e194
y.create.l HWIO_T_DBACK_SHARED_WORD38_ADDR A:0x6434e198
y.create.l HWIO_T_DBACK_NONHS_DRM_CFG_WORD0_ADDR A:0x6434e200
y.create.l HWIO_T_DBACK_NONHS_DRM_CFG_WORD1_ADDR A:0x6434e204
y.create.l HWIO_T_DBACK_NONHS_DRM_CFG_WORD2_ADDR A:0x6434e208
y.create.l HWIO_T_DBACK_NONHS_DRM_CFG_WORD3_ADDR A:0x6434e20c
y.create.l HWIO_T_DBACK_NONHS_DRM_CFG_WORD4_ADDR A:0x6434e210
y.create.l HWIO_T_DBACK_NONHS_DRM_CFG_WORD5_ADDR A:0x6434e214
y.create.l HWIO_T_DBACK_NONHS_DRM_CFG_WORD6_ADDR A:0x6434e218
y.create.l HWIO_T_DBACK_NONHS_DRM_CFG_WORD7_ADDR A:0x6434e21c
y.create.l HWIO_T_DBACK_NONHS_DRM_CFG_WORD8_ADDR A:0x6434e220
y.create.l HWIO_T_DBACK_NONHS_DRM_CFG_WORD9_ADDR A:0x6434e224
y.create.l HWIO_T_DBACK_NONHS_DRM_CFG_WORD10_ADDR A:0x6434e228
y.create.l HWIO_T_DBACK_NONHS_DRM_CFG_WORD11_ADDR A:0x6434e22c
y.create.l HWIO_T_DBACK_NONHS_DRM_CFG_WORD12_ADDR A:0x6434e230
y.create.l HWIO_T_DBACK_NONHS_DRM_CFG_WORD13_ADDR A:0x6434e234
y.create.l HWIO_T_DBACK_NONHS_DRM_CFG_WORD14_ADDR A:0x6434e238
y.create.l HWIO_T_DBACK_NONHS_DRM_CFG_WORD15_ADDR A:0x6434e23c
y.create.l HWIO_T_DBACK_NONHS_DRM_CFG_WORD16_ADDR A:0x6434e240
y.create.l HWIO_T_DBACK_NONHS_DRM_CFG_WORD17_ADDR A:0x6434e244
y.create.l HWIO_T_DBACK_NONHS_DRM_CFG_WORD18_ADDR A:0x6434e248
y.create.l HWIO_T_DBACK_NONHS_DRM_CFG_WORD19_ADDR A:0x6434e24c
y.create.l HWIO_T_DBACK_NONHS_DRM_CFG_WORD20_ADDR A:0x6434e250
y.create.l HWIO_T_DBACK_NONHS_DRM_CFG_WORD21_ADDR A:0x6434e254
y.create.l HWIO_T_DBACK_NONHS_DRM_CFG_WORD22_ADDR A:0x6434e258
y.create.l HWIO_T_DBACK_NONHS_DRM_CFG_WORD23_ADDR A:0x6434e25c
y.create.l HWIO_T_DBACK_NONHS_DRM_CFG_WORD24_ADDR A:0x6434e260
y.create.l HWIO_T_DBACK_NONHS_DRM_CFG_WORD25_ADDR A:0x6434e264
y.create.l HWIO_T_DBACK_NONHS_TD_DECIB_WRITER_CFG_WORD0_ADDR A:0x6434e300
y.create.l HWIO_T_DBACK_NONHS_TD_DECIB_WRITER_CFG_WORD1_ADDR A:0x6434e304
y.create.l HWIO_T_DBACK_HS_TD_DECIB_WRITER_CFG_WORD0_ADDR A:0x6434e400
y.create.l HWIO_T_DBACK_HS_TD_DECIB_WRITER_CFG_WORD1_ADDR A:0x6434e404
y.create.l HWIO_T_DBACK_HS_TD_DECIB_WRITER_CFG_WORD2_ADDR A:0x6434e408
y.create.l HWIO_T_DBACK_HS_TD_DECIB_WRITER_CFG_WORD3_ADDR A:0x6434e40c
y.create.l HWIO_T_DBACK_HS_TD_DECIB_WRITER_CFG_WORD4_ADDR A:0x6434e410
y.create.l HWIO_T_DBACK_HS_TD_DECIB_WRITER_CFG_WORD5_ADDR A:0x6434e414
y.create.l HWIO_T_DBACK_HS_TD_DECIB_WRITER_CFG_WORD6_ADDR A:0x6434e418
y.create.l HWIO_T_DBACK_HS_TD_DECIB_WRITER_CFG_WORD7_ADDR A:0x6434e41c
y.create.l HWIO_HDR_DEINT_CFG_WORD0_ADDR A:0x6434f100
y.create.l HWIO_HDR_DEINT_CFG_WORD1_ADDR A:0x6434f104
y.create.l HWIO_HDR_DEINT_CFG_WORD2_ADDR A:0x6434f108
y.create.l HWIO_HDR_DEINT_CFG_WORD3_ADDR A:0x6434f10c
y.create.l HWIO_HDR_DEINT_CFG_WORD4_ADDR A:0x6434f110
y.create.l HWIO_HDR_DEINT_CFG_WORD5_ADDR A:0x6434f114
y.create.l HWIO_HDR_DEINT_CFG_WORD6_ADDR A:0x6434f118
y.create.l HWIO_HDR_DEINT_CFG_WORD7_ADDR A:0x6434f11c
y.create.l HWIO_HDR_DEINT_CFG_WORD8_ADDR A:0x6434f120
y.create.l HWIO_HDR_DEINT_CFG_WORD9_ADDR A:0x6434f124
y.create.l HWIO_HDR_DEINT_CFG_WORD10_ADDR A:0x6434f128
y.create.l HWIO_HDR_DEINT_CFG_WORD11_ADDR A:0x6434f12c
y.create.l HWIO_HDR_DEINT_CFG_WORD12_ADDR A:0x6434f130
y.create.l HWIO_HDR_DEINT_CFG_WORD13_ADDR A:0x6434f134
y.create.l HWIO_HDR_DEINT_CFG_WORD14_ADDR A:0x6434f138
y.create.l HWIO_HDR_DEINT_CFG_WORD15_ADDR A:0x6434f13c
y.create.l HWIO_HDR_DEINT_CFG_WORD16_ADDR A:0x6434f140
y.create.l HWIO_HDR_DEINT_WORD0_ADDR A:0x6434f200
y.create.l HWIO_HDR_DEINT_WORD1_ADDR A:0x6434f204
y.create.l HWIO_HDR_DEINT_WORD2_ADDR A:0x6434f208
y.create.l HWIO_HDR_DEINT_WORD3_ADDR A:0x6434f20c
y.create.l HWIO_HDR_DEINT_WORD4_ADDR A:0x6434f210
y.create.l HWIO_HDR_DEINT_WORD5_ADDR A:0x6434f214
y.create.l HWIO_HDR_DEINT_WORD6_ADDR A:0x6434f218
y.create.l HWIO_HDR_DEINT_WORD7_ADDR A:0x6434f21c
y.create.l HWIO_HDR_DEINT_WORD8_ADDR A:0x6434f220
y.create.l HWIO_HDR_DEINT_WORD9_ADDR A:0x6434f224
y.create.l HWIO_HDR_DEINT_WORD10_ADDR A:0x6434f228
y.create.l HWIO_HDR_DEINT_WORD11_ADDR A:0x6434f22c
y.create.l HWIO_HDR_DEINT_WORD12_ADDR A:0x6434f230
y.create.l HWIO_HDR_DEINT_WORD13_ADDR A:0x6434f234
y.create.l HWIO_TBVD_CCH_STATUS_WORD0_ADDR A:0x64350000
y.create.l HWIO_TBVD_CCH_LTE_CFG_WORD0_ADDR A:0x64350100
y.create.l HWIO_TBVD_CCH_LTE_CFG_WORD1_ADDR A:0x64350104
y.create.l HWIO_TBVD_CCH_LTE_CFG_WORD2_ADDR A:0x64350108
y.create.l HWIO_TBVD_CCH_LTE_CFG_WORD3_ADDR A:0x6435010c
y.create.l HWIO_TBVD_CCH_LTE_CFG_WORD4_ADDR A:0x64350110
y.create.l HWIO_TBVD_CCH_LTE_CFG_WORD5_ADDR A:0x64350114
y.create.l HWIO_TBVD_CCH_LTE_CFG_WORD6_ADDR A:0x64350118
y.create.l HWIO_TBVD_CCH_LTE_CFG_WORD7_ADDR A:0x6435011c
y.create.l HWIO_TBVD_CCH_LTE_CFG_WORD8_ADDR A:0x64350120
y.create.l HWIO_TBVD_CCH_LTE_CFG_WORD9_ADDR A:0x64350124
y.create.l HWIO_TBVD_CCH_LTE_CFG_WORD10_ADDR A:0x64350128
y.create.l HWIO_TBVD_CCH_LTE_CFG_WORD11_ADDR A:0x6435012c
y.create.l HWIO_TBVD_CCH_LTE_CFG_WORD12_ADDR A:0x64350130
y.create.l HWIO_TBVD_CCH_LTE_CFG_WORD13_ADDR A:0x64350134
y.create.l HWIO_TBVD_CCH_LTE_CFG_WORD14_ADDR A:0x64350138
y.create.l HWIO_TBVD_CCH_LTE_CFG_WORD15_ADDR A:0x6435013c
y.create.l HWIO_TBVD_CCH_LTE_CFG_WORD16_ADDR A:0x64350140
y.create.l HWIO_TBVD_CCH_LTE_CFG_WORD17_ADDR A:0x64350144
y.create.l HWIO_TBVD_CCH_LTE_CFG_WORD18_ADDR A:0x64350148
y.create.l HWIO_TBVD_CCH_LTE_CFG_WORD19_ADDR A:0x6435014c
y.create.l HWIO_TBVD_CCH_LTE_PDCCH_WORD0_ADDR A:0x64350200
y.create.l HWIO_TBVD_CCH_LTE_PDCCH_WORD1_ADDR A:0x64350204
y.create.l HWIO_TBVD_CCH_LTE_PDCCH_WORD2_ADDR A:0x64350208
y.create.l HWIO_TBVD_CCH_LTE_PDCCH_WORD3_ADDR A:0x6435020c
y.create.l HWIO_TBVD_CCH_LTE_PDCCH_WORD4_ADDR A:0x64350210
y.create.l HWIO_TBVD_CCH_LTE_PDCCH_WORD5_ADDR A:0x64350214
y.create.l HWIO_TBVD_CCH_LTE_PDCCH_WORD6_ADDR A:0x64350218
y.create.l HWIO_DEC_O_CCH_W_NONHS_LTE_PBCH_WORD0_ADDR A:0x64350300
y.create.l HWIO_DEC_O_CCH_W_NONHS_LTE_PBCH_WORD1_ADDR A:0x64350304
y.create.l HWIO_DEC_O_CCH_W_NONHS_LTE_PBCH_WORD2_ADDR A:0x64350308
y.create.l HWIO_DECOB_MEM_BASE_MIN_ADDR A:0x64350500
y.create.l HWIO_DECOB_MEM_BASE_MIN_INT_ADDR A:0x64358500
y.create.l HWIO_DECOB_MEM_BASE_MAX_ADDR A:0x6435bdfc
y.create.l HWIO_HARQ_PAGE_START_ADDR A:0x6435c000
y.create.l HWIO_HARQ_PAGE_END_ADDR A:0x6435fffc
y.create.l HWIO_TDEC_CLK_CTL_ADDR A:0x6433c000
y.create.l HWIO_TDEC_SW_CLK_EN_ADDR A:0x6433c004
y.create.l HWIO_TDEC_CLK_STATUS_REG_ADDR A:0x6433c008
y.create.l HWIO_TDEC_MODE_CTL_ADDR A:0x6433c00c
y.create.l HWIO_TD_COMMON_CFG0_ADDR A:0x6433c020
y.create.l HWIO_TD_COMMON_CFG1_ADDR A:0x6433c024
y.create.l HWIO_TD_COMMON_CFG2_ADDR A:0x6433c028
y.create.l HWIO_TD_COMMON_CFG3_ADDR A:0x6433c02c
y.create.l HWIO_TD_COMMON_CFG4_ADDR A:0x6433c030
y.create.l HWIO_TD_COMMON_CFG5_ADDR A:0x6433c034
y.create.l HWIO_TD_COMMON_START_ADDR A:0x6433c038
y.create.l HWIO_TD_1X_CFG_ADDR A:0x6433c03c
y.create.l HWIO_TD_1X_DECOB_WRITE_PTR_ADDR A:0x6433c040
y.create.l HWIO_TDEC_HW_IDLE_ADDR A:0x6433c044
y.create.l HWIO_TDEC_PING_STATUS_0_ADDR A:0x6433c048
y.create.l HWIO_TDEC_PING_STATUS_1_ADDR A:0x6433c04c
y.create.l HWIO_TDEC_PONG_STATUS_0_ADDR A:0x6433c050
y.create.l HWIO_TDEC_PONG_STATUS_1_ADDR A:0x6433c054
y.create.l HWIO_TDEC_GERAN_STATUS_0_ADDR A:0x6433c058
y.create.l HWIO_TDEC_GERAN_STATUS_1_ADDR A:0x6433c05c
y.create.l HWIO_TDEC_TESTBUS_ENABLE_ADDR A:0x6433c060
y.create.l HWIO_TDEC_TESTBUS_STATUS_ADDR A:0x6433c064
y.create.l HWIO_DECIB_PAGE_ID_ADDR A:0x6433c068
y.create.l HWIO_TDEC_AHB_ERROR_ADDR_RD_ADDR A:0x6433c070
y.create.l HWIO_TEST_CRC_000_RD_ADDR A:0x6433c074
y.create.l HWIO_TEST_CRC_001_RD_ADDR A:0x6433c078
y.create.l HWIO_TEST_CRC_010_RD_ADDR A:0x6433c07c
y.create.l HWIO_TEST_CRC_011_RD_ADDR A:0x6433c080
y.create.l HWIO_TEST_CRC_100_RD_ADDR A:0x6433c084
y.create.l HWIO_TEST_CRC_101_RD_ADDR A:0x6433c088
y.create.l HWIO_TEST_CRC_110_RD_ADDR A:0x6433c08c
y.create.l HWIO_TEST_CRC_111_RD_ADDR A:0x6433c090
y.create.l HWIO_A2_TEST_SW_CFG_DATA0_ADDR A:0x6433c094
y.create.l HWIO_A2_TEST_SW_CFG_DATA1_ADDR A:0x6433c098
y.create.l HWIO_A2_TEST_SW_CFG_DATA2_ADDR A:0x6433c09c
y.create.l HWIO_A2_TEST_SW_CFG_DATA3_ADDR A:0x6433c0a0
y.create.l HWIO_A2_TEST_SW_CFG_DATA4_ADDR A:0x6433c0a4
y.create.l HWIO_TD_CFG_STATUS_WORD0_ADDR A:0x6433d000
y.create.l HWIO_LTE_CFG_WORD0_ADDR A:0x6433d100
y.create.l HWIO_LTE_CFG_WORD1_ADDR A:0x6433d104
y.create.l HWIO_LTE_CFG_WORD2_ADDR A:0x6433d108
y.create.l HWIO_W_TD_CFG_WORD0_0_ADDR A:0x6433d200
y.create.l HWIO_W_TD_CFG_WORD1_0_ADDR A:0x6433d204
y.create.l HWIO_W_TD_CFG_WORD2_0_ADDR A:0x6433d208
y.create.l HWIO_W_TD_CFG_WORD3_0_ADDR A:0x6433d20c
y.create.l HWIO_W_TD_CFG_WORD4_0_ADDR A:0x6433d210
y.create.l HWIO_W_TD_CFG_WORD5_0_ADDR A:0x6433d214
y.create.l HWIO_W_TD_CFG_WORD6_0_ADDR A:0x6433d218
y.create.l HWIO_W_TD_CFG_WORD7_0_ADDR A:0x6433d21c
y.create.l HWIO_W_TD_CFG_WORD8_0_ADDR A:0x6433d220
y.create.l HWIO_W_TD_CFG_WORD9_0_ADDR A:0x6433d224
y.create.l HWIO_W_TD_CFG_WORD0_1_ADDR A:0x6433d300
y.create.l HWIO_W_TD_CFG_WORD1_1_ADDR A:0x6433d304
y.create.l HWIO_W_TD_CFG_WORD2_1_ADDR A:0x6433d308
y.create.l HWIO_W_TD_CFG_WORD3_1_ADDR A:0x6433d30c
y.create.l HWIO_W_TD_CFG_WORD4_1_ADDR A:0x6433d310
y.create.l HWIO_W_TD_CFG_WORD5_1_ADDR A:0x6433d314
y.create.l HWIO_W_TD_CFG_WORD6_1_ADDR A:0x6433d318
y.create.l HWIO_W_TD_CFG_WORD7_1_ADDR A:0x6433d31c
y.create.l HWIO_W_TD_CFG_WORD8_1_ADDR A:0x6433d320
y.create.l HWIO_W_TD_CFG_WORD9_1_ADDR A:0x6433d324
y.create.l HWIO_LTE_TRBLK_CFG_WORD0_0_ADDR A:0x6433d400
y.create.l HWIO_LTE_TRBLK_CFG_WORD1_0_ADDR A:0x6433d404
y.create.l HWIO_LTE_TRBLK_CFG_WORD2_0_ADDR A:0x6433d408
y.create.l HWIO_LTE_TRBLK_CFG_WORD3_0_ADDR A:0x6433d40c
y.create.l HWIO_LTE_TRBLK_CFG_WORD4_0_ADDR A:0x6433d410
y.create.l HWIO_LTE_TRBLK_CFG_WORD5_0_ADDR A:0x6433d414
y.create.l HWIO_LTE_TRBLK_CFG_WORD0_1_ADDR A:0x6433d500
y.create.l HWIO_LTE_TRBLK_CFG_WORD1_1_ADDR A:0x6433d504
y.create.l HWIO_LTE_TRBLK_CFG_WORD2_1_ADDR A:0x6433d508
y.create.l HWIO_LTE_TRBLK_CFG_WORD3_1_ADDR A:0x6433d50c
y.create.l HWIO_LTE_TRBLK_CFG_WORD4_1_ADDR A:0x6433d510
y.create.l HWIO_LTE_TRBLK_CFG_WORD5_1_ADDR A:0x6433d514
y.create.l HWIO_GERAN_TD_CFG_WORD0_0_ADDR A:0x6433d600
y.create.l HWIO_GERAN_TD_CFG_WORD1_0_ADDR A:0x6433d604
y.create.l HWIO_GERAN_TD_CFG_WORD2_0_ADDR A:0x6433d608
y.create.l HWIO_GERAN_TD_CFG_WORD3_0_ADDR A:0x6433d60c
y.create.l HWIO_GERAN_TD_CFG_WORD0_1_ADDR A:0x6433d700
y.create.l HWIO_GERAN_TD_CFG_WORD1_1_ADDR A:0x6433d704
y.create.l HWIO_GERAN_TD_CFG_WORD2_1_ADDR A:0x6433d708
y.create.l HWIO_GERAN_TD_CFG_WORD3_1_ADDR A:0x6433d70c
y.create.l HWIO_HDR_TD_CFG_WORD0_0_ADDR A:0x6433d800
y.create.l HWIO_HDR_TD_CFG_WORD1_0_ADDR A:0x6433d804
y.create.l HWIO_HDR_TD_CFG_WORD2_0_ADDR A:0x6433d808
y.create.l HWIO_HDR_TD_CFG_WORD0_1_ADDR A:0x6433d900
y.create.l HWIO_HDR_TD_CFG_WORD1_1_ADDR A:0x6433d904
y.create.l HWIO_HDR_TD_CFG_WORD2_1_ADDR A:0x6433d908
y.create.l HWIO_TD_STATUS_WORD0_ADDR A:0x6433e000
y.create.l HWIO_W_TD_WORD0_0_ADDR A:0x6433e100
y.create.l HWIO_W_TD_WORD0_1_ADDR A:0x6433e200
y.create.l HWIO_LTE_PDSCH_WORD0_0_ADDR A:0x6433e300
y.create.l HWIO_LTE_PDSCH_WORD1_0_ADDR A:0x6433e304
y.create.l HWIO_LTE_PDSCH_WORD2_0_ADDR A:0x6433e308
y.create.l HWIO_LTE_PDSCH_WORD0_1_ADDR A:0x6433e400
y.create.l HWIO_LTE_PDSCH_WORD1_1_ADDR A:0x6433e404
y.create.l HWIO_LTE_PDSCH_WORD2_1_ADDR A:0x6433e408
y.create.l HWIO_GERAN_TD_WORD0_0_ADDR A:0x6433e500
y.create.l HWIO_GERAN_TD_WORD1_0_ADDR A:0x6433e504
y.create.l HWIO_GERAN_TD_WORD2_0_ADDR A:0x6433e508
y.create.l HWIO_GERAN_TD_WORD3_0_ADDR A:0x6433e50c
y.create.l HWIO_GERAN_TD_WORD4_0_ADDR A:0x6433e510
y.create.l HWIO_GERAN_TD_WORD5_0_ADDR A:0x6433e514
y.create.l HWIO_GERAN_TD_WORD6_0_ADDR A:0x6433e518
y.create.l HWIO_GERAN_TD_WORD0_1_ADDR A:0x6433e600
y.create.l HWIO_GERAN_TD_WORD1_1_ADDR A:0x6433e604
y.create.l HWIO_GERAN_TD_WORD2_1_ADDR A:0x6433e608
y.create.l HWIO_GERAN_TD_WORD3_1_ADDR A:0x6433e60c
y.create.l HWIO_GERAN_TD_WORD4_1_ADDR A:0x6433e610
y.create.l HWIO_GERAN_TD_WORD5_1_ADDR A:0x6433e614
y.create.l HWIO_GERAN_TD_WORD6_1_ADDR A:0x6433e618
y.create.l HWIO_HDR_TD_WORD0_0_ADDR A:0x6433e700
y.create.l HWIO_HDR_TD_WORD1_0_ADDR A:0x6433e704
y.create.l HWIO_HDR_TD_WORD2_0_ADDR A:0x6433e708
y.create.l HWIO_HDR_TD_WORD3_0_ADDR A:0x6433e70c
y.create.l HWIO_HDR_TD_WORD4_0_ADDR A:0x6433e710
y.create.l HWIO_HDR_TD_WORD5_0_ADDR A:0x6433e714
y.create.l HWIO_HDR_TD_WORD0_1_ADDR A:0x6433e800
y.create.l HWIO_HDR_TD_WORD1_1_ADDR A:0x6433e804
y.create.l HWIO_HDR_TD_WORD2_1_ADDR A:0x6433e808
y.create.l HWIO_HDR_TD_WORD3_1_ADDR A:0x6433e80c
y.create.l HWIO_HDR_TD_WORD4_1_ADDR A:0x6433e810
y.create.l HWIO_HDR_TD_WORD5_1_ADDR A:0x6433e814
y.create.l HWIO_TDECIB_MEM_START_ADDR A:0x6433f000
y.create.l HWIO_TDECIB_MEM_END_ADDR A:0x6433fffc
y.create.l HWIO_PDMEM_MIN_ADDR A:0x64300000
y.create.l HWIO_PDMEM_MAX_ADDR A:0x6430fffc
y.create.l HWIO_CCS_MSTS_ADDR A:0x6431fc00
y.create.l HWIO_CCS_MCTL_ADDR A:0x6431fc04
y.create.l HWIO_CCS_IPC_ADDR A:0x6431fc08
y.create.l HWIO_CCS_PIC0MSK_ADDR A:0x6431fc0c
y.create.l HWIO_CCS_PIC0STS_ADDR A:0x6431fc10
y.create.l HWIO_CCS_PIC1MSK_ADDR A:0x6431fc14
y.create.l HWIO_CCS_PIC1STS_ADDR A:0x6431fc18
y.create.l HWIO_CCS_PIC2MSK_ADDR A:0x6431fc1c
y.create.l HWIO_CCS_PIC2STS_ADDR A:0x6431fc20
y.create.l HWIO_CCS_PIC3MSK_ADDR A:0x6431fc24
y.create.l HWIO_CCS_PIC3STS_ADDR A:0x6431fc28
y.create.l HWIO_CCS_PIC4MSK_ADDR A:0x6431fc2c
y.create.l HWIO_CCS_PIC4STS_ADDR A:0x6431fc30
y.create.l HWIO_CCS_PIC5MSK_ADDR A:0x6431fc34
y.create.l HWIO_CCS_PIC5STS_ADDR A:0x6431fc38
y.create.l HWIO_CCS_PIC6MSK_ADDR A:0x6431fc3c
y.create.l HWIO_CCS_PIC6STS_ADDR A:0x6431fc40
y.create.l HWIO_CCS_PIT_ADDR A:0x6431fc44
y.create.l HWIO_CCS_UTIME_ADDR A:0x6431fc48
y.create.l HWIO_CCS_MON0_ADDR A:0x6431fc4c
y.create.l HWIO_CCS_MON1_ADDR A:0x6431fc50
y.create.l HWIO_CCS_MON2_ADDR A:0x6431fc54
y.create.l HWIO_CCS_MON3_ADDR A:0x6431fc58
y.create.l HWIO_CCS_MON4_ADDR A:0x6431fc5c
y.create.l HWIO_CCS_MON5_ADDR A:0x6431fc60
y.create.l HWIO_CCS_MON6_ADDR A:0x6431fc64
y.create.l HWIO_CCS_MON7_ADDR A:0x6431fc68
y.create.l HWIO_CCS_MON8_ADDR A:0x6431fc6c
y.create.l HWIO_CCS_MON9_ADDR A:0x6431fc70
y.create.l HWIO_CCS_TMR0_ADDR A:0x6431fc7c
y.create.l HWIO_CCS_TMR1_ADDR A:0x6431fc80
y.create.l HWIO_CCS_TMR2_ADDR A:0x6431fc84
y.create.l HWIO_CCS_TMR3_ADDR A:0x6431fc88
y.create.l HWIO_CCS_DMAC_ADDR A:0x6431fc8c
y.create.l HWIO_CCS_DMAC0SRC_ADDR A:0x6431fc90
y.create.l HWIO_CCS_DMAC1SRC_ADDR A:0x6431fca0
y.create.l HWIO_CCS_DMAC2SRC_ADDR A:0x6431fcb0
y.create.l HWIO_CCS_DMAC3SRC_ADDR A:0x6431fcc0
y.create.l HWIO_CCS_DMAC4SRC_ADDR A:0x6431fcd0
y.create.l HWIO_CCS_DMAC5SRC_ADDR A:0x6431fce0
y.create.l HWIO_CCS_DMAC6SRC_ADDR A:0x6431fcf0
y.create.l HWIO_CCS_DMAC7SRC_ADDR A:0x6431fd00
y.create.l HWIO_CCS_DMAC0DST_ADDR A:0x6431fc94
y.create.l HWIO_CCS_DMAC1DST_ADDR A:0x6431fca4
y.create.l HWIO_CCS_DMAC2DST_ADDR A:0x6431fcb4
y.create.l HWIO_CCS_DMAC3DST_ADDR A:0x6431fcc4
y.create.l HWIO_CCS_DMAC4DST_ADDR A:0x6431fcd4
y.create.l HWIO_CCS_DMAC5DST_ADDR A:0x6431fce4
y.create.l HWIO_CCS_DMAC6DST_ADDR A:0x6431fcf4
y.create.l HWIO_CCS_DMAC7DST_ADDR A:0x6431fd04
y.create.l HWIO_CCS_DMAC0LNK_ADDR A:0x6431fc98
y.create.l HWIO_CCS_DMAC1LNK_ADDR A:0x6431fca8
y.create.l HWIO_CCS_DMAC2LNK_ADDR A:0x6431fcb8
y.create.l HWIO_CCS_DMAC3LNK_ADDR A:0x6431fcc8
y.create.l HWIO_CCS_DMAC4LNK_ADDR A:0x6431fcd8
y.create.l HWIO_CCS_DMAC5LNK_ADDR A:0x6431fce8
y.create.l HWIO_CCS_DMAC6LNK_ADDR A:0x6431fcf8
y.create.l HWIO_CCS_DMAC7LNK_ADDR A:0x6431fd08
y.create.l HWIO_CCS_DMAC0CTL_ADDR A:0x6431fc9c
y.create.l HWIO_CCS_DMAC1CTL_ADDR A:0x6431fcac
y.create.l HWIO_CCS_DMAC2CTL_ADDR A:0x6431fcbc
y.create.l HWIO_CCS_DMAC3CTL_ADDR A:0x6431fccc
y.create.l HWIO_CCS_DMAC4CTL_ADDR A:0x6431fcdc
y.create.l HWIO_CCS_DMAC5CTL_ADDR A:0x6431fcec
y.create.l HWIO_CCS_DMAC6CTL_ADDR A:0x6431fcfc
y.create.l HWIO_CCS_DMAC7CTL_ADDR A:0x6431fd0c
y.create.l HWIO_CCS_RFI_ADDR A:0x6431fd10
y.create.l HWIO_CCS_SSBI0_ADDR A:0x6431fd14
y.create.l HWIO_CCS_SSBI1_ADDR A:0x6431fd1c
y.create.l HWIO_CCS_SSBI2_ADDR A:0x6431fd24
y.create.l HWIO_CCS_SSBI3_ADDR A:0x6431fd2c
y.create.l HWIO_CCS_SSBI0DAT_ADDR A:0x6431fd18
y.create.l HWIO_CCS_SSBI1DAT_ADDR A:0x6431fd20
y.create.l HWIO_CCS_SSBI2DAT_ADDR A:0x6431fd28
y.create.l HWIO_CCS_SSBI3DAT_ADDR A:0x6431fd30
y.create.l HWIO_CCS_GRFC_SET_ADDR A:0x6431fd44
y.create.l HWIO_CCS_GRFC_CLR_ADDR A:0x6431fd48
y.create.l HWIO_CCS_RFFE0_ADDR A:0x6431fd4c
y.create.l HWIO_CCS_RFFE1_ADDR A:0x6431fd64
y.create.l HWIO_CCS_RFFE2_ADDR A:0x6431fd7c
y.create.l HWIO_CCS_RFFE3_ADDR A:0x6431fd94
y.create.l HWIO_CCS_RFFE4_ADDR A:0x6431fdac
y.create.l HWIO_CCS_RFFE0DAT0_ADDR A:0x6431fd50
y.create.l HWIO_CCS_RFFE1DAT0_ADDR A:0x6431fd68
y.create.l HWIO_CCS_RFFE2DAT0_ADDR A:0x6431fd80
y.create.l HWIO_CCS_RFFE3DAT0_ADDR A:0x6431fd98
y.create.l HWIO_CCS_RFFE4DAT0_ADDR A:0x6431fdb0
y.create.l HWIO_CCS_RFFE0DAT1_ADDR A:0x6431fd54
y.create.l HWIO_CCS_RFFE1DAT1_ADDR A:0x6431fd6c
y.create.l HWIO_CCS_RFFE2DAT1_ADDR A:0x6431fd84
y.create.l HWIO_CCS_RFFE3DAT1_ADDR A:0x6431fd9c
y.create.l HWIO_CCS_RFFE4DAT1_ADDR A:0x6431fdb4
y.create.l HWIO_CCS_RFFE0DAT2_ADDR A:0x6431fd58
y.create.l HWIO_CCS_RFFE1DAT2_ADDR A:0x6431fd70
y.create.l HWIO_CCS_RFFE2DAT2_ADDR A:0x6431fd88
y.create.l HWIO_CCS_RFFE3DAT2_ADDR A:0x6431fda0
y.create.l HWIO_CCS_RFFE4DAT2_ADDR A:0x6431fdb8
y.create.l HWIO_CCS_RFFE0DAT3_ADDR A:0x6431fd5c
y.create.l HWIO_CCS_RFFE1DAT3_ADDR A:0x6431fd74
y.create.l HWIO_CCS_RFFE2DAT3_ADDR A:0x6431fd8c
y.create.l HWIO_CCS_RFFE3DAT3_ADDR A:0x6431fda4
y.create.l HWIO_CCS_RFFE4DAT3_ADDR A:0x6431fdbc
y.create.l HWIO_CCS_RFFE0_STS_ADDR A:0x6431fd60
y.create.l HWIO_CCS_RFFE1_STS_ADDR A:0x6431fd78
y.create.l HWIO_CCS_RFFE2_STS_ADDR A:0x6431fd90
y.create.l HWIO_CCS_RFFE3_STS_ADDR A:0x6431fda8
y.create.l HWIO_CCS_RFFE4_STS_ADDR A:0x6431fdc0
y.create.l HWIO_CCS_BP0_ADDR A:0x6431fe3c
y.create.l HWIO_CCS_BP1_ADDR A:0x6431fe40
y.create.l HWIO_MTC_ENABLE_ADDR A:0x64320000
y.create.l HWIO_MODEM_PWRUP_ADDR A:0x64320004
y.create.l HWIO_MODEM_PWRON_ADDR A:0x64320008
y.create.l HWIO_MODEM_ID_ADDR A:0x6432000c
y.create.l HWIO_MODEM_FEATURE_EN_ADDR A:0x64320010
y.create.l HWIO_MODEM_OPTION_EN_ADDR A:0x64320014
y.create.l HWIO_MODEM_CLK_AXI_CFG_ADDR A:0x64320018
y.create.l HWIO_MODEM_CLK_AXI_TRIG_ADDR A:0x6432001c
y.create.l HWIO_MODEM_CLK_AXI_STATUS_ADDR A:0x64320020
y.create.l HWIO_MODEM_CLK_TDEC_CFG_ADDR A:0x64320024
y.create.l HWIO_MODEM_CLK_TDEC_TRIG_ADDR A:0x64320028
y.create.l HWIO_MODEM_CLK_TDEC_STATUS_ADDR A:0x6432002c
y.create.l HWIO_MODEM_CLK_DBG_CFG_ADDR A:0x64320030
y.create.l HWIO_MODEM_CLK_SPARE_ADDR A:0x64320034
y.create.l HWIO_MODEM_BRIC_MAXI2AXI_TESTBUS_ADDR A:0x64320038
y.create.l HWIO_MODEM_BRIC_MAXI2AXI_TESTBUS_SEL_ADDR A:0x6432003c
y.create.l HWIO_MCDMA_RESET_ADDR A:0x64320400
y.create.l HWIO_MCDMA_ENABLE_ADDR A:0x6432049c
y.create.l HWIO_MCDMA_LOG_CH_BUSY_ADDR A:0x64320404
y.create.l HWIO_MCDMA_LOG_HW_CH0_SYNC_ADDR A:0x64320408
y.create.l HWIO_MCDMA_LOG_HW_CH1_SYNC_ADDR A:0x6432040c
y.create.l HWIO_MCDMA_LOG_HW_CH2_SYNC_ADDR A:0x64320410
y.create.l HWIO_MCDMA_LOG_HW_CH3_SYNC_ADDR A:0x64320414
y.create.l HWIO_MCDMA_LOG_HW_CH4_SYNC_ADDR A:0x64320418
y.create.l HWIO_MCDMA_LOG_HW_CH0_CTL_ADDR A:0x64320420
y.create.l HWIO_MCDMA_LOG_HW_CH1_CTL_ADDR A:0x64320424
y.create.l HWIO_MCDMA_LOG_HW_CH2_CTL_ADDR A:0x64320428
y.create.l HWIO_MCDMA_LOG_HW_CH3_CTL_ADDR A:0x6432042c
y.create.l HWIO_MCDMA_LOG_HW_CH4_CTL_ADDR A:0x64320430
y.create.l HWIO_MCDMA_LOG_SW_CH0_RESET_ADDR A:0x64320438
y.create.l HWIO_MCDMA_LOG_SW_CH1_RESET_ADDR A:0x6432043c
y.create.l HWIO_MCDMA_LOG_SW_CH2_RESET_ADDR A:0x64320440
y.create.l HWIO_MCDMA_LOG_SW_CH3_RESET_ADDR A:0x64320444
y.create.l HWIO_MCDMA_LOG_SW_CH0_CTL_ADDR A:0x6432044c
y.create.l HWIO_MCDMA_LOG_SW_CH1_CTL_ADDR A:0x64320450
y.create.l HWIO_MCDMA_LOG_SW_CH2_CTL_ADDR A:0x64320454
y.create.l HWIO_MCDMA_LOG_SW_CH3_CTL_ADDR A:0x64320458
y.create.l HWIO_MCDMA_PHY_CH_CTL_ADDR A:0x64320460
y.create.l HWIO_MCDMA_LOG_HW_CH0_DBG_ADDR A:0x64320464
y.create.l HWIO_MCDMA_LOG_HW_CH1_DBG_ADDR A:0x64320468
y.create.l HWIO_MCDMA_LOG_HW_CH2_DBG_ADDR A:0x6432046c
y.create.l HWIO_MCDMA_LOG_HW_CH3_DBG_ADDR A:0x64320470
y.create.l HWIO_MCDMA_LOG_HW_CH4_DBG_ADDR A:0x64320474
y.create.l HWIO_MCDMA_LOG_SW_CH0_DBG_ADDR A:0x64320478
y.create.l HWIO_MCDMA_LOG_SW_CH1_DBG_ADDR A:0x6432047c
y.create.l HWIO_MCDMA_LOG_SW_CH2_DBG_ADDR A:0x64320480
y.create.l HWIO_MCDMA_LOG_SW_CH3_DBG_ADDR A:0x64320484
y.create.l HWIO_MCDMA_PHY_CH_DBG_ADDR A:0x64320488
y.create.l HWIO_MCDMA_VBUF_CFG_DBG_ADDR A:0x6432048c
y.create.l HWIO_MCDMA_VBUF_CFG_SEL_ADDR A:0x64320490
y.create.l HWIO_MCDMA_VBUF_CFG_RD0_ADDR A:0x64320494
y.create.l HWIO_MCDMA_VBUF_CFG_RD1_ADDR A:0x64320498
y.create.l HWIO_A2_SW_RESET_THRD_ADDR A:0x64320800
y.create.l HWIO_A2_SW_RESET_ACC_ADDR A:0x64320804
y.create.l HWIO_A2_TASK0_EN_ADDR A:0x64320808
y.create.l HWIO_A2_TASK1_EN_ADDR A:0x6432080c
y.create.l HWIO_A2_TASK2_EN_ADDR A:0x64320810
y.create.l HWIO_A2_TASK3_EN_ADDR A:0x64320814
y.create.l HWIO_A2_TASK0_WR_PTR_ADDR A:0x64320820
y.create.l HWIO_A2_TASK1_WR_PTR_ADDR A:0x64320824
y.create.l HWIO_A2_TASK2_WR_PTR_ADDR A:0x64320828
y.create.l HWIO_A2_TASK3_WR_PTR_ADDR A:0x6432082c
y.create.l HWIO_A2_TASK0_RD_PTR_ADDR A:0x64320840
y.create.l HWIO_A2_TASK1_RD_PTR_ADDR A:0x64320844
y.create.l HWIO_A2_TASK2_RD_PTR_ADDR A:0x64320848
y.create.l HWIO_A2_TASK3_RD_PTR_ADDR A:0x6432084c
y.create.l HWIO_A2_TASK0_RD_PTR_INIT_ADDR A:0x64320860
y.create.l HWIO_A2_TASK1_RD_PTR_INIT_ADDR A:0x64320864
y.create.l HWIO_A2_TASK2_RD_PTR_INIT_ADDR A:0x64320868
y.create.l HWIO_A2_TASK3_RD_PTR_INIT_ADDR A:0x6432086c
y.create.l HWIO_A2_TASK0_RD_PTR_INIT_EN_ADDR A:0x64320880
y.create.l HWIO_A2_TASK1_RD_PTR_INIT_EN_ADDR A:0x64320884
y.create.l HWIO_A2_TASK2_RD_PTR_INIT_EN_ADDR A:0x64320888
y.create.l HWIO_A2_TASK3_RD_PTR_INIT_EN_ADDR A:0x6432088c
y.create.l HWIO_A2_QUEUE_UPPER_ADDR_ADDR A:0x643208b0
y.create.l HWIO_A2_STATUS0_WR_EN_ADDR A:0x643208c8
y.create.l HWIO_A2_STATUS1_WR_EN_ADDR A:0x643208cc
y.create.l HWIO_A2_STATUS2_WR_EN_ADDR A:0x643208d0
y.create.l HWIO_A2_STATUS3_WR_EN_ADDR A:0x643208d4
y.create.l HWIO_A2_STATUS4_WR_EN_ADDR A:0x643208d8
y.create.l HWIO_A2_STATUS0_WR_START_ADDR A:0x643208dc
y.create.l HWIO_A2_STATUS1_WR_START_ADDR A:0x643208e0
y.create.l HWIO_A2_STATUS2_WR_START_ADDR A:0x643208e4
y.create.l HWIO_A2_STATUS3_WR_START_ADDR A:0x643208e8
y.create.l HWIO_A2_STATUS4_WR_START_ADDR A:0x643208ec
y.create.l HWIO_A2_STATUS0_WR_END_ADDR A:0x643208f0
y.create.l HWIO_A2_STATUS1_WR_END_ADDR A:0x643208f4
y.create.l HWIO_A2_STATUS2_WR_END_ADDR A:0x643208f8
y.create.l HWIO_A2_STATUS3_WR_END_ADDR A:0x643208fc
y.create.l HWIO_A2_STATUS4_WR_END_ADDR A:0x64320900
y.create.l HWIO_A2_STATUS0_WR_PTR_INIT_ADDR A:0x64320904
y.create.l HWIO_A2_STATUS1_WR_PTR_INIT_ADDR A:0x64320908
y.create.l HWIO_A2_STATUS2_WR_PTR_INIT_ADDR A:0x6432090c
y.create.l HWIO_A2_STATUS3_WR_PTR_INIT_ADDR A:0x64320910
y.create.l HWIO_A2_STATUS4_WR_PTR_INIT_ADDR A:0x64320914
y.create.l HWIO_A2_STATUS0_WR_PTR_INIT_EN_ADDR A:0x64320918
y.create.l HWIO_A2_STATUS1_WR_PTR_INIT_EN_ADDR A:0x6432091c
y.create.l HWIO_A2_STATUS2_WR_PTR_INIT_EN_ADDR A:0x64320920
y.create.l HWIO_A2_STATUS3_WR_PTR_INIT_EN_ADDR A:0x64320924
y.create.l HWIO_A2_STATUS4_WR_PTR_INIT_EN_ADDR A:0x64320928
y.create.l HWIO_A2_STATUS0_WR_PTR_CURRENT_ADDR A:0x6432092c
y.create.l HWIO_A2_STATUS1_WR_PTR_CURRENT_ADDR A:0x64320930
y.create.l HWIO_A2_STATUS2_WR_PTR_CURRENT_ADDR A:0x64320934
y.create.l HWIO_A2_STATUS3_WR_PTR_CURRENT_ADDR A:0x64320938
y.create.l HWIO_A2_STATUS4_WR_PTR_CURRENT_ADDR A:0x6432093c
y.create.l HWIO_A2_STATUS0_WR_PTR_ADDR A:0x64320940
y.create.l HWIO_A2_STATUS1_WR_PTR_ADDR A:0x64320944
y.create.l HWIO_A2_STATUS2_WR_PTR_ADDR A:0x64320948
y.create.l HWIO_A2_STATUS3_WR_PTR_ADDR A:0x6432094c
y.create.l HWIO_A2_STATUS4_WR_PTR_ADDR A:0x64320950
y.create.l HWIO_A2_STATUS0_RD_PTR_ADDR A:0x64320954
y.create.l HWIO_A2_STATUS1_RD_PTR_ADDR A:0x64320958
y.create.l HWIO_A2_STATUS2_RD_PTR_ADDR A:0x6432095c
y.create.l HWIO_A2_STATUS3_RD_PTR_ADDR A:0x64320960
y.create.l HWIO_A2_STATUS4_RD_PTR_ADDR A:0x64320964
y.create.l HWIO_A2_FRAG0_THRESHOLD_ADDR A:0x643209c0
y.create.l HWIO_A2_FRAG1_THRESHOLD_ADDR A:0x643209c4
y.create.l HWIO_A2_FRAG0_REFILL_EN_ADDR A:0x643209c8
y.create.l HWIO_A2_FRAG1_REFILL_EN_ADDR A:0x643209cc
y.create.l HWIO_A2_FRAG0_LEN_ADDR A:0x643209d0
y.create.l HWIO_A2_FRAG1_LEN_ADDR A:0x643209d4
y.create.l HWIO_A2_FRAG0_ADDR_ADDR A:0x643209d8
y.create.l HWIO_A2_FRAG1_ADDR_ADDR A:0x643209dc
y.create.l HWIO_A2_FRAG0_PTR_ADDR A:0x643209e0
y.create.l HWIO_A2_FRAG1_PTR_ADDR A:0x643209e4
y.create.l HWIO_A2_FRAG_CACHE_LINE_ADDR A:0x643209e8
y.create.l HWIO_A2_FRAG_CACHE_LINE_MASK_ADDR A:0x643209ec
y.create.l HWIO_A2_FRAG0_TRANSFER_LEN_ADDR A:0x643209f0
y.create.l HWIO_A2_FRAG1_TRANSFER_LEN_ADDR A:0x643209f4
y.create.l HWIO_A2_FRAG0_HDR_LEN_ADDR A:0x643209f8
y.create.l HWIO_A2_FRAG1_HDR_LEN_ADDR A:0x643209fc
y.create.l HWIO_A2_FRAG0_QUEUE_START_ADDR_ADDR A:0x64320a08
y.create.l HWIO_A2_FRAG1_QUEUE_START_ADDR_ADDR A:0x64320a0c
y.create.l HWIO_A2_FRAG0_QUEUE_WR_PTR_ADDR A:0x64320aa0
y.create.l HWIO_A2_FRAG1_QUEUE_WR_PTR_ADDR A:0x64320aa4
y.create.l HWIO_A2_FRAG0_QUEUE_RD_PTR_ADDR A:0x64320aa8
y.create.l HWIO_A2_FRAG1_QUEUE_RD_PTR_ADDR A:0x64320aac
y.create.l HWIO_A2_FRAG0_RD_PTR_INIT_EN_ADDR A:0x64320acc
y.create.l HWIO_A2_FRAG1_RD_PTR_INIT_EN_ADDR A:0x64320ad0
y.create.l HWIO_A2_TIMER0_CFG_ADDR A:0x64320a10
y.create.l HWIO_A2_TIMER1_CFG_ADDR A:0x64320a14
y.create.l HWIO_A2_TIMER2_CFG_ADDR A:0x64320a18
y.create.l HWIO_A2_TIMER3_CFG_ADDR A:0x64320a1c
y.create.l HWIO_A2_TIMER0_CMD_ADDR A:0x64320a20
y.create.l HWIO_A2_TIMER1_CMD_ADDR A:0x64320a24
y.create.l HWIO_A2_TIMER2_CMD_ADDR A:0x64320a28
y.create.l HWIO_A2_TIMER3_CMD_ADDR A:0x64320a2c
y.create.l HWIO_A2_TIMER0_PERIOD_ADDR A:0x64320a40
y.create.l HWIO_A2_TIMER1_PERIOD_ADDR A:0x64320a44
y.create.l HWIO_A2_TIMER2_PERIOD_ADDR A:0x64320a48
y.create.l HWIO_A2_TIMER3_PERIOD_ADDR A:0x64320a4c
y.create.l HWIO_A2_TIMER0_STATUS_ADDR A:0x64320a50
y.create.l HWIO_A2_TIMER1_STATUS_ADDR A:0x64320a54
y.create.l HWIO_A2_TIMER2_STATUS_ADDR A:0x64320a58
y.create.l HWIO_A2_TIMER3_STATUS_ADDR A:0x64320a5c
y.create.l HWIO_A2_PER_DL_CFG_ADDR A:0x64320a70
y.create.l HWIO_A2_PER0_UL_CFG_ADDR A:0x64320a74
y.create.l HWIO_A2_PER1_UL_CFG_ADDR A:0x64320a78
y.create.l HWIO_A2_PER2_UL_CFG_ADDR A:0x64320a7c
y.create.l HWIO_A2_CKSUM_CFG_ADDR A:0x64320adc
y.create.l HWIO_A2_DL_PHY_DEC_TRBLK_THRESHOLD_ADDR A:0x64320a90
y.create.l HWIO_A2_DL_PHY_CFG_ADDR A:0x64320a94
y.create.l HWIO_A2_HW_THRD_EN_ADDR A:0x64320a98
y.create.l HWIO_A2_UL_PHY_CFG_ADDR A:0x64320a9c
y.create.l HWIO_A2_LTE_DLPHY_CMD_ADDR_ADDR A:0x64320ab0
y.create.l HWIO_A2_IP_FILT_FRAG_ADDR_ADDR A:0x64320ab4
y.create.l HWIO_A2_MCDMA_DMA_IN_ADDR_ADDR A:0x64320ab8
y.create.l HWIO_A2_MCDMA_DMA_OUT_ADDR_ADDR A:0x64320abc
y.create.l HWIO_A2_MCDMA_TASK_ADDR_ADDR A:0x64320ac0
y.create.l HWIO_A2_MCDMA_BAM_NDP_ADDR_ADDR A:0x64320ac4
y.create.l HWIO_A2_DECOB_PREFETCH_ADDR_ADDR A:0x64320ac8
y.create.l HWIO_A2_MCDMA_OST_BRST_ADDR A:0x64320ad4
y.create.l HWIO_A2_MCDMA_MAX_BRST_SIZE_ADDR A:0x64320ad8
y.create.l HWIO_A2_HW_CLK_CTL_ADDR A:0x64320ae0
y.create.l HWIO_A2_CLK_EN_CTL_ADDR A:0x64320ae4
y.create.l HWIO_A2_CLK_STATUS_ADDR A:0x64320ae8
y.create.l HWIO_A2_UL_PER_1ST_PKT_INT_EN_ADDR A:0x64320aec
y.create.l HWIO_A2_DBG_LINK_RD_ADDR A:0x64320af0
y.create.l HWIO_A2_DBG_LINK1_RD_ADDR A:0x64320af4
y.create.l HWIO_A2_DBG_FRAG0_LEN_ADDR A:0x64320af8
y.create.l HWIO_A2_DBG_FRAG1_LEN_ADDR A:0x64320afc
y.create.l HWIO_A2_DBG_FRAG2_LEN_ADDR A:0x64320b00
y.create.l HWIO_A2_DBG_FRAG3_LEN_ADDR A:0x64320b04
y.create.l HWIO_A2_DBG_FRAG4_LEN_ADDR A:0x64320b08
y.create.l HWIO_A2_DBG_FRAG0_ADDR_CUR_ADDR A:0x64320b0c
y.create.l HWIO_A2_DBG_FRAG1_ADDR_CUR_ADDR A:0x64320b10
y.create.l HWIO_A2_DBG_FRAG2_ADDR_CUR_ADDR A:0x64320b14
y.create.l HWIO_A2_DBG_FRAG3_ADDR_CUR_ADDR A:0x64320b18
y.create.l HWIO_A2_DBG_FRAG4_ADDR_CUR_ADDR A:0x64320b1c
y.create.l HWIO_A2_DBG_FRAG0_ADDR_NXT_ADDR A:0x64320b20
y.create.l HWIO_A2_DBG_FRAG1_ADDR_NXT_ADDR A:0x64320b24
y.create.l HWIO_A2_DBG_FRAG2_ADDR_NXT_ADDR A:0x64320b28
y.create.l HWIO_A2_DBG_FRAG3_ADDR_NXT_ADDR A:0x64320b2c
y.create.l HWIO_A2_DBG_FRAG4_ADDR_NXT_ADDR A:0x64320b30
y.create.l HWIO_A2_DBG_FRAG0_PTR_ADDR A:0x64320b34
y.create.l HWIO_A2_DBG_FRAG1_PTR_ADDR A:0x64320b38
y.create.l HWIO_A2_DBG_FRAG2_PTR_ADDR A:0x64320b3c
y.create.l HWIO_A2_DBG_FRAG3_PTR_ADDR A:0x64320b40
y.create.l HWIO_A2_DBG_FRAG4_PTR_ADDR A:0x64320b44
y.create.l HWIO_A2_DBG_TRBLK_LENGTH_ADDR A:0x64320b60
y.create.l HWIO_A2_DBG_TRBLK_START_ADDR_ADDR A:0x64320b64
y.create.l HWIO_A2_DBG_TRBLK_SW_INFO0_ADDR A:0x64320b68
y.create.l HWIO_A2_DBG_TRBLK_SW_INFO1_ADDR A:0x64320b6c
y.create.l HWIO_A2_DBG_TRBLK_TRIGGER_ADDR A:0x64320b70
y.create.l HWIO_A2_DBG_TRBLK_STATUS_ADDR A:0x64320b74
y.create.l HWIO_A2_DBG_STRM_ID_ADDR A:0x64320b80
y.create.l HWIO_A2_DBG_DMA_SRC_ADDR A:0x64320b84
y.create.l HWIO_A2_DBG_DMA_DST_ADDR A:0x64320b8c
y.create.l HWIO_A2_DBG_DMA_CTL_ADDR A:0x64320b90
y.create.l HWIO_A2_DBG_TASK_FETCHER_ADDR A:0x64320b94
y.create.l HWIO_A2_DBG_DL0_BAM_ADDR A:0x64320b98
y.create.l HWIO_A2_DBG_DL1_BAM_ADDR A:0x64320b9c
y.create.l HWIO_A2_DBG_DL2_BAM_ADDR A:0x64320ba0
y.create.l HWIO_A2_DBG_UL0_BAM_ADDR A:0x64320ba4
y.create.l HWIO_A2_DBG_UL1_BAM_ADDR A:0x64320ba8
y.create.l HWIO_A2_DBG_UL2_BAM_ADDR A:0x64320bac
y.create.l HWIO_A2_DBG_FRM_ADDR A:0x64320bb0
y.create.l HWIO_A2_DBG_DFRM_ADDR A:0x64320bb4
y.create.l HWIO_A2_DBG_CIPH_ADDR A:0x64320bb8
y.create.l HWIO_A2_DBG_IPF_ADDR A:0x64320bbc
y.create.l HWIO_A2_DBG_MIU0_ADDR A:0x64320bc0
y.create.l HWIO_A2_DBG_MIU1_ADDR A:0x64320bc4
y.create.l HWIO_A2_DBG_MIU2_ADDR A:0x64320bc8
y.create.l HWIO_A2_DBG_MIU3_ADDR A:0x64320bcc
y.create.l HWIO_A2_DBG_TASK_WORD_ADDR A:0x64320bd0
y.create.l HWIO_A2_DBG_UL_CKSUM0_ADDR A:0x64320bd4
y.create.l HWIO_A2_DBG_UL_CKSUM1_ADDR A:0x64320bd8
y.create.l HWIO_A2_DBG_DL_CKSUM0_ADDR A:0x64320bdc
y.create.l HWIO_A2_DBG_DL_CKSUM1_ADDR A:0x64320be0
y.create.l HWIO_A2_DBG_CKSUM_UL_EOT_ADDR A:0x64320be4
y.create.l HWIO_DBG_RESET_ADDR A:0x64320c00
y.create.l HWIO_DBG_ENABLE_ADDR A:0x64320c04
y.create.l HWIO_DBG_LOG_STATUS_ADDR A:0x64320c08
y.create.l HWIO_DBG_MUX_MASK_0_ADDR A:0x64320c0c
y.create.l HWIO_DBG_MUX_MASK_1_ADDR A:0x64320c10
y.create.l HWIO_DBG_MUX_MASK_2_ADDR A:0x64320c14
y.create.l HWIO_DBG_MUX_MASK_3_ADDR A:0x64320c18
y.create.l HWIO_DBG_MUX_MASK_4_ADDR A:0x64320c1c
y.create.l HWIO_DBG_MUX_MASK_5_ADDR A:0x64320c20
y.create.l HWIO_DBG_MUX_MASK_6_ADDR A:0x64320c24
y.create.l HWIO_DBG_MUX_MASK_7_ADDR A:0x64320c28
y.create.l HWIO_DBG_MUX_MASK_8_ADDR A:0x64320c2c
y.create.l HWIO_DBG_MUX_MASK_9_ADDR A:0x64320c30
y.create.l HWIO_DBG_PORT_MUX_ADDR A:0x64320c4c
y.create.l HWIO_DBG_ERR_IRQ_MASK0_ADDR A:0x64320c50
y.create.l HWIO_DBG_ERR_IRQ_MASK1_ADDR A:0x64320c54
y.create.l HWIO_DBG_SW_LOG_ADDR A:0x64320c58
y.create.l HWIO_DBG_DATA_DST_ADDR A:0x64320c5c
y.create.l HWIO_DBG_START_ADDR_ADDR A:0x64320c60
y.create.l HWIO_DBG_EXT_MEM_CNT_VAL_ADDR A:0x64320c64
y.create.l HWIO_DBG_SHRD_START_ADDR_ADDR A:0x64320c68
y.create.l HWIO_DBG_SHRD_END_ADDR_ADDR A:0x64320c6c
y.create.l HWIO_DBG_MAX_OST_BURSTS_ADDR A:0x64320c70
y.create.l HWIO_DBG_ERR_IRQ_EN0_ADDR A:0x64320c74
y.create.l HWIO_DBG_ERR_IRQ_EN1_ADDR A:0x64320c78
y.create.l HWIO_DBG_ERR_IRQ_CLR0_ADDR A:0x64320c7c
y.create.l HWIO_DBG_ERR_IRQ_CLR1_ADDR A:0x64320c80
y.create.l HWIO_DBG_ERR_IRQ_STATUS0_ADDR A:0x64320c84
y.create.l HWIO_DBG_ERR_IRQ_STATUS1_ADDR A:0x64320c88
y.create.l HWIO_MTC_BRDG_MCDMA_RD_ENABLE_ADDR A:0x6432100c
y.create.l HWIO_MTC_BRDG_MCDMA_WR_ENABLE_ADDR A:0x64321010
y.create.l HWIO_MTC_BRDG_A2_RD_ENABLE_ADDR A:0x64321014
y.create.l HWIO_MTC_BRDG_CTL_ADDR A:0x64321000
y.create.l HWIO_MTC_BRDG_STATUS_ADDR A:0x64321004
y.create.l HWIO_MTC_BRDG_CLEAR_ADDR A:0x64321008
y.create.l HWIO_A2_SHRD_MEM_BASE_MIN_ADDR A:0x64322000
y.create.l HWIO_A2_SHRD_MEM_BASE_MAX_ADDR A:0x6432367c
y.create.l HWIO_MCDMA_TS_STATUS_WORD0_ADDR A:0x64324000
y.create.l HWIO_MCDMA_TS_VBUF_CFG_WORD0_ADDR A:0x64324100
y.create.l HWIO_MCDMA_TS_VBUF_CFG_WORD1_ADDR A:0x64324104
y.create.l HWIO_MCDMA_TS_DMA_CH0_WORD0_ADDR A:0x64324200
y.create.l HWIO_MCDMA_TS_DMA_CH0_WORD1_ADDR A:0x64324204
y.create.l HWIO_MCDMA_TS_DMA_CH0_WORD2_ADDR A:0x64324208
y.create.l HWIO_MCDMA_TS_DMA_CH1_WORD0_ADDR A:0x64324300
y.create.l HWIO_MCDMA_TS_DMA_CH1_WORD1_ADDR A:0x64324304
y.create.l HWIO_MCDMA_TS_DMA_CH1_WORD2_ADDR A:0x64324308
y.create.l HWIO_MCDMA_TS_DMA_CH2_WORD0_ADDR A:0x64324400
y.create.l HWIO_MCDMA_TS_DMA_CH2_WORD1_ADDR A:0x64324404
y.create.l HWIO_MCDMA_TS_DMA_CH2_WORD2_ADDR A:0x64324408
y.create.l HWIO_MCDMA_TS_DMA_CH3_WORD0_ADDR A:0x64324500
y.create.l HWIO_MCDMA_TS_DMA_CH3_WORD1_ADDR A:0x64324504
y.create.l HWIO_MCDMA_TS_DMA_CH3_WORD2_ADDR A:0x64324508
y.create.l HWIO_DBG_STATUS_WORD0_ADDR A:0x64324800
y.create.l HWIO_DBG_TASK_WORD0_ADDR A:0x64324900
y.create.l HWIO_DBG_TASK_WORD1_ADDR A:0x64324904
y.create.l HWIO_UNIV_STMR_MSTMR_EXPY_ADDR A:0x64324c00
y.create.l HWIO_ENCRYPT_ACC_RESET_ADDR A:0x64325000
y.create.l HWIO_ENCRYPT_ACC_CGC_CTL_ADDR A:0x64325004
y.create.l HWIO_ENCRYPT_ACC_CGC_STATUS_ADDR A:0x64325008
y.create.l HWIO_GEA_CONFIG_0_ADDR A:0x6432500c
y.create.l HWIO_GEA_INPUT_ADDR A:0x64325010
y.create.l HWIO_GEA_KC_0_ADDR A:0x64325014
y.create.l HWIO_GEA_KC_1_ADDR A:0x64325018
y.create.l HWIO_AMBA_KEY_STRM_WORD0_RD_ADDR A:0x6432501c
y.create.l HWIO_AMBA_KEY_STRM_WORD1_RD_ADDR A:0x64325020
y.create.l HWIO_AMBA_KEY_STRM_WORD2_RD_ADDR A:0x64325024
y.create.l HWIO_AMBA_KEY_STRM_WORD3_RD_ADDR A:0x64325028
y.create.l HWIO_AMBA_KEY_STRM_WORD4_RD_ADDR A:0x6432502c
y.create.l HWIO_AMBA_KEY_STRM_WORD5_RD_ADDR A:0x64325030
y.create.l HWIO_AMBA_KEY_STRM_WORD6_RD_ADDR A:0x64325034
y.create.l HWIO_AMBA_KEY_STRM_WORD7_RD_ADDR A:0x64325038
y.create.l HWIO_AMBA_KEY_STRM_STATUS_ADDR A:0x6432503c
y.create.l HWIO_AFIVE_CONFIG_0_ADDR A:0x64325040
y.create.l HWIO_AFIVE_INPUT_ADDR A:0x64325044
y.create.l HWIO_AFIVE_KC_0_ADDR A:0x64325048
y.create.l HWIO_AFIVE_KC_1_ADDR A:0x6432504c
y.create.l HWIO_AFIVE_KEY_STRM_WORD0_RD_ADDR A:0x64325050
y.create.l HWIO_AFIVE_KEY_STRM_WORD1_RD_ADDR A:0x64325054
y.create.l HWIO_AFIVE_KEY_STRM_WORD2_RD_ADDR A:0x64325058
y.create.l HWIO_AFIVE_KEY_STRM_WORD3_RD_ADDR A:0x6432505c
y.create.l HWIO_AFIVE_KEY_STRM_WORD4_RD_ADDR A:0x64325060
y.create.l HWIO_AFIVE_KEY_STRM_WORD5_RD_ADDR A:0x64325064
y.create.l HWIO_AFIVE_KEY_STRM_WORD6_RD_ADDR A:0x64325068
y.create.l HWIO_AFIVE_KEY_STRM_WORD7_RD_ADDR A:0x6432506c
y.create.l HWIO_AFIVE_KEY_STRM_WORD8_RD_ADDR A:0x64325070
y.create.l HWIO_AFIVE_KEY_STRM_WORD9_RD_ADDR A:0x64325074
y.create.l HWIO_UNIV_STMR_RESET_ADDR A:0x64328800
y.create.l HWIO_UNIV_STMR_ENABLE_ADDR A:0x64328804
y.create.l HWIO_UNIV_STMR_MSTMR_ADDR A:0x64328808
y.create.l HWIO_UNIV_STMR_SYNC_CMD_ADDR A:0x6432880c
y.create.l HWIO_UNIV_STMR_MODIFIER_ADJ_ADDR A:0x64328810
y.create.l HWIO_UNIV_STMR_STATUS_ADDR A:0x64328814
y.create.l HWIO_UNIV_STMR_STATUS_DUMP_CMD_ADDR A:0x64328834
y.create.l HWIO_UNIV_STMR_TIME_STATUS_RD_ADDR A:0x64328838
y.create.l HWIO_TX_C0_CTRL_SEL_ADDR A:0x64328880
y.create.l HWIO_TX_C0_TRIG_CMD_ADDR A:0x64328888
y.create.l HWIO_TX_C0_TRIG_VAL_ADDR A:0x64328890
y.create.l HWIO_TX_TRIG_STATUS_ADDR A:0x643288a8
y.create.l HWIO_TX_C0_TRIG_RD_ADDR A:0x643288b0
y.create.l HWIO_UNIV_STMR_TX_SYNC_TIME0_ADDR A:0x643288d0
y.create.l HWIO_UNIV_STMR_TRIG_CTRL_ADDR A:0x643288d8
y.create.l HWIO_UNIV_STMR_TRIG_MASK_ADDR A:0x643288dc
y.create.l HWIO_VFR_SEL_ADDR A:0x643288e0
y.create.l HWIO_UNIV_STMR_SPARE_ADDR A:0x643288e4
y.create.l HWIO_UNIV_STMR_LD_CMD_ADDR A:0x643288ec
y.create.l HWIO_UNIV_STMR_MODIFIER_LD_ADDR A:0x643288f0
y.create.l HWIO_TX_DAC0_UPDATE_STRT_TRIG_CMD_ADDR A:0x64328908
y.create.l HWIO_TX_DAC0_UPDATE_STRT_VAL_ADDR A:0x64328910
y.create.l HWIO_TX_DAC0_UPDATE_STOP_TRIG_CMD_ADDR A:0x64328918
y.create.l HWIO_TX_DAC0_UPDATE_STOP_VAL_ADDR A:0x64328920
y.create.l HWIO_TX_DAC0_IREF_GAIN_ADDR A:0x64328928
y.create.l HWIO_DACCOMP_MUX_CHAIN0_STRT_TRIG_CMD_ADDR A:0x64328930
y.create.l HWIO_DACCOMP_MUX_CHAIN0_STRT_VAL_ADDR A:0x64328938
y.create.l HWIO_DACCOMP_MUX_CHAIN0_STOP_TRIG_CMD_ADDR A:0x64328940
y.create.l HWIO_DACCOMP_MUX_CHAIN0_STOP_VAL_ADDR A:0x64328948
y.create.l HWIO_DACCOMP_MUX_CHAIN0_STRT_TRIG_RD_ADDR A:0x64328950
y.create.l HWIO_DACCOMP_MUX_CHAIN0_STOP_TRIG_RD_ADDR A:0x64328958
y.create.l HWIO_RXFE_C0_TRIG_CMD_ADDR A:0x64328980
y.create.l HWIO_RXFE_C1_TRIG_CMD_ADDR A:0x64328984
y.create.l HWIO_RXFE_C0_TRIG_VAL_ADDR A:0x643289a0
y.create.l HWIO_RXFE_C1_TRIG_VAL_ADDR A:0x643289a4
y.create.l HWIO_RXFE_TRIG_STATUS_ADDR A:0x643289c0
y.create.l HWIO_RXFE_C0_TRIG_RD_ADDR A:0x643289d0
y.create.l HWIO_RXFE_C1_TRIG_RD_ADDR A:0x643289d4
y.create.l HWIO_STMR_TIME_RD_ADDR A:0x64328b00
y.create.l HWIO_STMR_EVT_MATCH_0_ADDR A:0x64328b04
y.create.l HWIO_STMR_EVT_MATCH_1_ADDR A:0x64328b08
y.create.l HWIO_STMR_EVT_MATCH_2_ADDR A:0x64328b0c
y.create.l HWIO_STMR_EVT_MATCH_3_ADDR A:0x64328b10
y.create.l HWIO_STMR_EVT_MATCH_4_ADDR A:0x64328b14
y.create.l HWIO_STMR_EVT_MATCH_5_ADDR A:0x64328b18
y.create.l HWIO_STMR_EVT_MATCH_6_ADDR A:0x64328b1c
y.create.l HWIO_STMR_EVT_MATCH_7_ADDR A:0x64328b20
y.create.l HWIO_STMR_EVT_MATCH_8_ADDR A:0x64328b24
y.create.l HWIO_STMR_EVT_MATCH_9_ADDR A:0x64328b28
y.create.l HWIO_OCIMEM_HW_VERSION_ADDR A:0x60050000
y.create.l HWIO_OCIMEM_HW_PROFILE_ADDR A:0x60050004
y.create.l HWIO_OCIMEM_GEN_CTL_ADDR A:0x60050008
y.create.l HWIO_OCIMEM_GEN_STAT_ADDR A:0x6005000c
y.create.l HWIO_OCIMEM_INTC_CLR_ADDR A:0x60050010
y.create.l HWIO_OCIMEM_INTC_MASK_ADDR A:0x60050014
y.create.l HWIO_OCIMEM_INTC_STAT_ADDR A:0x60050018
y.create.l HWIO_OCIMEM_OSW_STATUS_ADDR A:0x6005001c
y.create.l HWIO_OCIMEM_PSCGC_TIMERS_ADDR A:0x60050034
y.create.l HWIO_OCIMEM_PSCGC_STAT_ADDR A:0x60050038
y.create.l HWIO_OCIMEM_PSCGC_M0_M7_CTL_ADDR A:0x6005003c
y.create.l HWIO_OCIMEM_ERR_ADDRESS_ADDR A:0x60050060
y.create.l HWIO_OCIMEM_AXI_ERR_SYNDROME_ADDR A:0x60050064
y.create.l HWIO_OCIMEM_DEBUG_CTL_ADDR A:0x60050068
y.create.l HWIO_OCIMEM_MPU_XPU_SCR_ADDR A:0x60053000
y.create.l HWIO_OCIMEM_MPU_XPU_SWDR_ADDR A:0x60053004
y.create.l HWIO_OCIMEM_MPU_XPU_PRTN_RACR_SSHADOW_ADDR A:0x60053008
y.create.l HWIO_OCIMEM_MPU_XPU_PRTN_WACR_SSHADOW_ADDR A:0x6005300c
y.create.l HWIO_OCIMEM_MPU_XPU_PRTN_START_SSHADOW0_ADDR A:0x60053010
y.create.l HWIO_OCIMEM_MPU_XPU_PRTN_END_SSHADOW0_ADDR A:0x60053018
y.create.l HWIO_OCIMEM_MPU_XPU_SEAR0_ADDR A:0x60053040
y.create.l HWIO_OCIMEM_MPU_XPU_SESR_ADDR A:0x60053048
y.create.l HWIO_OCIMEM_MPU_XPU_SESRRESTORE_ADDR A:0x6005304c
y.create.l HWIO_OCIMEM_MPU_XPU_SESYNR0_ADDR A:0x60053050
y.create.l HWIO_OCIMEM_MPU_XPU_SESYNR1_ADDR A:0x60053054
y.create.l HWIO_OCIMEM_MPU_XPU_SESYNR2_ADDR A:0x60053058
y.create.l HWIO_OCIMEM_MPU_XPU_MCR_ADDR A:0x60053100
y.create.l HWIO_OCIMEM_MPU_XPU_MEAR0_ADDR A:0x60053140
y.create.l HWIO_OCIMEM_MPU_XPU_MESR_ADDR A:0x60053148
y.create.l HWIO_OCIMEM_MPU_XPU_MESRRESTORE_ADDR A:0x6005314c
y.create.l HWIO_OCIMEM_MPU_XPU_MESYNR0_ADDR A:0x60053150
y.create.l HWIO_OCIMEM_MPU_XPU_MESYNR1_ADDR A:0x60053154
y.create.l HWIO_OCIMEM_MPU_XPU_MESYNR2_ADDR A:0x60053158
y.create.l HWIO_OCIMEM_MPU_XPU_CR_ADDR A:0x60053080
y.create.l HWIO_OCIMEM_MPU_XPU_PRTN_RACR_SHADOW_ADDR A:0x60053088
y.create.l HWIO_OCIMEM_MPU_XPU_PRTN_WACR_SHADOW_ADDR A:0x6005308c
y.create.l HWIO_OCIMEM_MPU_XPU_PRTN_START_SHADOW0_ADDR A:0x60053090
y.create.l HWIO_OCIMEM_MPU_XPU_PRTN_END_SHADOW0_ADDR A:0x60053098
y.create.l HWIO_OCIMEM_MPU_XPU_RPU_ACR0_ADDR A:0x600530a0
y.create.l HWIO_OCIMEM_MPU_XPU_EAR0_ADDR A:0x600530c0
y.create.l HWIO_OCIMEM_MPU_XPU_ESR_ADDR A:0x600530c8
y.create.l HWIO_OCIMEM_MPU_XPU_ESRRESTORE_ADDR A:0x600530cc
y.create.l HWIO_OCIMEM_MPU_XPU_ESYNR0_ADDR A:0x600530d0
y.create.l HWIO_OCIMEM_MPU_XPU_ESYNR1_ADDR A:0x600530d4
y.create.l HWIO_OCIMEM_MPU_XPU_ESYNR2_ADDR A:0x600530d8
y.create.l HWIO_OCIMEM_MPU_XPU_UMR_RACR_ADDR A:0x600530e0
y.create.l HWIO_OCIMEM_MPU_XPU_UMR_WACR_ADDR A:0x600530e4
y.create.l HWIO_OCIMEM_MPU_XPU_UMR_CNTL_ADDR A:0x600530f0
y.create.l HWIO_OCIMEM_MPU_XPU_IDR0_ADDR A:0x60053074
y.create.l HWIO_OCIMEM_MPU_XPU_IDR1_ADDR A:0x60053078
y.create.l HWIO_OCIMEM_MPU_XPU_REV_ADDR A:0x6005307c
y.create.l HWIO_OCIMEM_MPU_XPU_PRT0_RACR0_ADDR A:0x60053200
y.create.l HWIO_OCIMEM_MPU_XPU_PRT1_RACR0_ADDR A:0x60053280
y.create.l HWIO_OCIMEM_MPU_XPU_PRT2_RACR0_ADDR A:0x60053300
y.create.l HWIO_OCIMEM_MPU_XPU_PRT3_RACR0_ADDR A:0x60053380
y.create.l HWIO_OCIMEM_MPU_XPU_PRT4_RACR0_ADDR A:0x60053400
y.create.l HWIO_OCIMEM_MPU_XPU_PRT5_RACR0_ADDR A:0x60053480
y.create.l HWIO_OCIMEM_MPU_XPU_PRT6_RACR0_ADDR A:0x60053500
y.create.l HWIO_OCIMEM_MPU_XPU_PRT7_RACR0_ADDR A:0x60053580
y.create.l HWIO_OCIMEM_MPU_XPU_PRT0_WACR0_ADDR A:0x60053220
y.create.l HWIO_OCIMEM_MPU_XPU_PRT1_WACR0_ADDR A:0x600532a0
y.create.l HWIO_OCIMEM_MPU_XPU_PRT2_WACR0_ADDR A:0x60053320
y.create.l HWIO_OCIMEM_MPU_XPU_PRT3_WACR0_ADDR A:0x600533a0
y.create.l HWIO_OCIMEM_MPU_XPU_PRT4_WACR0_ADDR A:0x60053420
y.create.l HWIO_OCIMEM_MPU_XPU_PRT5_WACR0_ADDR A:0x600534a0
y.create.l HWIO_OCIMEM_MPU_XPU_PRT6_WACR0_ADDR A:0x60053520
y.create.l HWIO_OCIMEM_MPU_XPU_PRT7_WACR0_ADDR A:0x600535a0
y.create.l HWIO_OCIMEM_MPU_XPU_PRT0_START0_ADDR A:0x60053240
y.create.l HWIO_OCIMEM_MPU_XPU_PRT1_START0_ADDR A:0x600532c0
y.create.l HWIO_OCIMEM_MPU_XPU_PRT2_START0_ADDR A:0x60053340
y.create.l HWIO_OCIMEM_MPU_XPU_PRT3_START0_ADDR A:0x600533c0
y.create.l HWIO_OCIMEM_MPU_XPU_PRT4_START0_ADDR A:0x60053440
y.create.l HWIO_OCIMEM_MPU_XPU_PRT5_START0_ADDR A:0x600534c0
y.create.l HWIO_OCIMEM_MPU_XPU_PRT6_START0_ADDR A:0x60053540
y.create.l HWIO_OCIMEM_MPU_XPU_PRT7_START0_ADDR A:0x600535c0
y.create.l HWIO_OCIMEM_MPU_XPU_PRT0_END0_ADDR A:0x60053248
y.create.l HWIO_OCIMEM_MPU_XPU_PRT1_END0_ADDR A:0x600532c8
y.create.l HWIO_OCIMEM_MPU_XPU_PRT2_END0_ADDR A:0x60053348
y.create.l HWIO_OCIMEM_MPU_XPU_PRT3_END0_ADDR A:0x600533c8
y.create.l HWIO_OCIMEM_MPU_XPU_PRT4_END0_ADDR A:0x60053448
y.create.l HWIO_OCIMEM_MPU_XPU_PRT5_END0_ADDR A:0x600534c8
y.create.l HWIO_OCIMEM_MPU_XPU_PRT6_END0_ADDR A:0x60053548
y.create.l HWIO_OCIMEM_MPU_XPU_PRT7_END0_ADDR A:0x600535c8
y.create.l HWIO_OCIMEM_MPU_XPU_PRT0_SCR_ADDR A:0x60053250
y.create.l HWIO_OCIMEM_MPU_XPU_PRT1_SCR_ADDR A:0x600532d0
y.create.l HWIO_OCIMEM_MPU_XPU_PRT2_SCR_ADDR A:0x60053350
y.create.l HWIO_OCIMEM_MPU_XPU_PRT3_SCR_ADDR A:0x600533d0
y.create.l HWIO_OCIMEM_MPU_XPU_PRT4_SCR_ADDR A:0x60053450
y.create.l HWIO_OCIMEM_MPU_XPU_PRT5_SCR_ADDR A:0x600534d0
y.create.l HWIO_OCIMEM_MPU_XPU_PRT6_SCR_ADDR A:0x60053550
y.create.l HWIO_OCIMEM_MPU_XPU_PRT7_SCR_ADDR A:0x600535d0
y.create.l HWIO_OCIMEM_MPU_XPU_PRT0_MCR_ADDR A:0x60053254
y.create.l HWIO_OCIMEM_MPU_XPU_PRT1_MCR_ADDR A:0x600532d4
y.create.l HWIO_OCIMEM_MPU_XPU_PRT2_MCR_ADDR A:0x60053354
y.create.l HWIO_OCIMEM_MPU_XPU_PRT3_MCR_ADDR A:0x600533d4
y.create.l HWIO_OCIMEM_MPU_XPU_PRT4_MCR_ADDR A:0x60053454
y.create.l HWIO_OCIMEM_MPU_XPU_PRT5_MCR_ADDR A:0x600534d4
y.create.l HWIO_OCIMEM_MPU_XPU_PRT6_MCR_ADDR A:0x60053554
y.create.l HWIO_OCIMEM_MPU_XPU_PRT7_MCR_ADDR A:0x600535d4
y.create.l HWIO_OCIMEM_MPU_XPU_PRT0_CNTL0_ADDR A:0x60053258
y.create.l HWIO_OCIMEM_MPU_XPU_PRT1_CNTL0_ADDR A:0x600532d8
y.create.l HWIO_OCIMEM_MPU_XPU_PRT2_CNTL0_ADDR A:0x60053358
y.create.l HWIO_OCIMEM_MPU_XPU_PRT3_CNTL0_ADDR A:0x600533d8
y.create.l HWIO_OCIMEM_MPU_XPU_PRT4_CNTL0_ADDR A:0x60053458
y.create.l HWIO_OCIMEM_MPU_XPU_PRT5_CNTL0_ADDR A:0x600534d8
y.create.l HWIO_OCIMEM_MPU_XPU_PRT6_CNTL0_ADDR A:0x60053558
y.create.l HWIO_OCIMEM_MPU_XPU_PRT7_CNTL0_ADDR A:0x600535d8
y.create.l HWIO_OCIMEM_MPU_XPU_PRT0_CNTL1_ADDR A:0x6005325c
y.create.l HWIO_OCIMEM_MPU_XPU_PRT1_CNTL1_ADDR A:0x600532dc
y.create.l HWIO_OCIMEM_MPU_XPU_PRT2_CNTL1_ADDR A:0x6005335c
y.create.l HWIO_OCIMEM_MPU_XPU_PRT3_CNTL1_ADDR A:0x600533dc
y.create.l HWIO_OCIMEM_MPU_XPU_PRT4_CNTL1_ADDR A:0x6005345c
y.create.l HWIO_OCIMEM_MPU_XPU_PRT5_CNTL1_ADDR A:0x600534dc
y.create.l HWIO_OCIMEM_MPU_XPU_PRT6_CNTL1_ADDR A:0x6005355c
y.create.l HWIO_OCIMEM_MPU_XPU_PRT7_CNTL1_ADDR A:0x600535dc
y.create.l HWIO_PCNOC_0_ABT_HW_VERSION_ADDR A:0x60023000
y.create.l HWIO_PCNOC_0_ABT_INST_ID_ADDR A:0x60023004
y.create.l HWIO_PCNOC_0_ABT_NUM_SLAVES_ADDR A:0x60023008
y.create.l HWIO_PCNOC_0_ABT_TIMER_LOADVAL_ADDR A:0x6002300c
y.create.l HWIO_PCNOC_0_ABT_TIMER_MODE_ADDR A:0x60023010
y.create.l HWIO_PCNOC_0_ABT_INTR_STATUS_ADDR A:0x60023014
y.create.l HWIO_PCNOC_0_ABT_INTR_CLEAR_ADDR A:0x60023018
y.create.l HWIO_PCNOC_0_ABT_INTR_ENABLE_ADDR A:0x6002301c
y.create.l HWIO_PCNOC_0_ABT_SYND_VALID_ADDR A:0x60023020
y.create.l HWIO_PCNOC_0_ABT_SYND_CLEAR_ADDR A:0x60023024
y.create.l HWIO_PCNOC_0_ABT_SYND_ID_ADDR A:0x60023028
y.create.l HWIO_PCNOC_0_ABT_SYND_ADDR0_ADDR A:0x6002302c
y.create.l HWIO_PCNOC_0_ABT_SYND_ADDR1_ADDR A:0x60023030
y.create.l HWIO_PCNOC_0_ABT_SYND_HREADY_ADDR A:0x60023034
y.create.l HWIO_PCNOC_1_ABT_HW_VERSION_ADDR A:0x60024000
y.create.l HWIO_PCNOC_1_ABT_INST_ID_ADDR A:0x60024004
y.create.l HWIO_PCNOC_1_ABT_NUM_SLAVES_ADDR A:0x60024008
y.create.l HWIO_PCNOC_1_ABT_TIMER_LOADVAL_ADDR A:0x6002400c
y.create.l HWIO_PCNOC_1_ABT_TIMER_MODE_ADDR A:0x60024010
y.create.l HWIO_PCNOC_1_ABT_INTR_STATUS_ADDR A:0x60024014
y.create.l HWIO_PCNOC_1_ABT_INTR_CLEAR_ADDR A:0x60024018
y.create.l HWIO_PCNOC_1_ABT_INTR_ENABLE_ADDR A:0x6002401c
y.create.l HWIO_PCNOC_1_ABT_SYND_VALID_ADDR A:0x60024020
y.create.l HWIO_PCNOC_1_ABT_SYND_CLEAR_ADDR A:0x60024024
y.create.l HWIO_PCNOC_1_ABT_SYND_ID_ADDR A:0x60024028
y.create.l HWIO_PCNOC_1_ABT_SYND_ADDR0_ADDR A:0x6002402c
y.create.l HWIO_PCNOC_1_ABT_SYND_ADDR1_ADDR A:0x60024030
y.create.l HWIO_PCNOC_1_ABT_SYND_HREADY_ADDR A:0x60024034
y.create.l HWIO_PCNOC_2_ABT_HW_VERSION_ADDR A:0x60025000
y.create.l HWIO_PCNOC_2_ABT_INST_ID_ADDR A:0x60025004
y.create.l HWIO_PCNOC_2_ABT_NUM_SLAVES_ADDR A:0x60025008
y.create.l HWIO_PCNOC_2_ABT_TIMER_LOADVAL_ADDR A:0x6002500c
y.create.l HWIO_PCNOC_2_ABT_TIMER_MODE_ADDR A:0x60025010
y.create.l HWIO_PCNOC_2_ABT_INTR_STATUS_ADDR A:0x60025014
y.create.l HWIO_PCNOC_2_ABT_INTR_CLEAR_ADDR A:0x60025018
y.create.l HWIO_PCNOC_2_ABT_INTR_ENABLE_ADDR A:0x6002501c
y.create.l HWIO_PCNOC_2_ABT_SYND_VALID_ADDR A:0x60025020
y.create.l HWIO_PCNOC_2_ABT_SYND_CLEAR_ADDR A:0x60025024
y.create.l HWIO_PCNOC_2_ABT_SYND_ID_ADDR A:0x60025028
y.create.l HWIO_PCNOC_2_ABT_SYND_ADDR0_ADDR A:0x6002502c
y.create.l HWIO_PCNOC_2_ABT_SYND_ADDR1_ADDR A:0x60025030
y.create.l HWIO_PCNOC_2_ABT_SYND_HREADY_ADDR A:0x60025034
y.create.l HWIO_PCNOC_3_ABT_HW_VERSION_ADDR A:0x60026000
y.create.l HWIO_PCNOC_3_ABT_INST_ID_ADDR A:0x60026004
y.create.l HWIO_PCNOC_3_ABT_NUM_SLAVES_ADDR A:0x60026008
y.create.l HWIO_PCNOC_3_ABT_TIMER_LOADVAL_ADDR A:0x6002600c
y.create.l HWIO_PCNOC_3_ABT_TIMER_MODE_ADDR A:0x60026010
y.create.l HWIO_PCNOC_3_ABT_INTR_STATUS_ADDR A:0x60026014
y.create.l HWIO_PCNOC_3_ABT_INTR_CLEAR_ADDR A:0x60026018
y.create.l HWIO_PCNOC_3_ABT_INTR_ENABLE_ADDR A:0x6002601c
y.create.l HWIO_PCNOC_3_ABT_SYND_VALID_ADDR A:0x60026020
y.create.l HWIO_PCNOC_3_ABT_SYND_CLEAR_ADDR A:0x60026024
y.create.l HWIO_PCNOC_3_ABT_SYND_ID_ADDR A:0x60026028
y.create.l HWIO_PCNOC_3_ABT_SYND_ADDR0_ADDR A:0x6002602c
y.create.l HWIO_PCNOC_3_ABT_SYND_ADDR1_ADDR A:0x60026030
y.create.l HWIO_PCNOC_3_ABT_SYND_HREADY_ADDR A:0x60026034
y.create.l HWIO_PCNOC_4_ABT_HW_VERSION_ADDR A:0x68801000
y.create.l HWIO_PCNOC_4_ABT_INST_ID_ADDR A:0x68801004
y.create.l HWIO_PCNOC_4_ABT_NUM_SLAVES_ADDR A:0x68801008
y.create.l HWIO_PCNOC_4_ABT_TIMER_LOADVAL_ADDR A:0x6880100c
y.create.l HWIO_PCNOC_4_ABT_TIMER_MODE_ADDR A:0x68801010
y.create.l HWIO_PCNOC_4_ABT_INTR_STATUS_ADDR A:0x68801014
y.create.l HWIO_PCNOC_4_ABT_INTR_CLEAR_ADDR A:0x68801018
y.create.l HWIO_PCNOC_4_ABT_INTR_ENABLE_ADDR A:0x6880101c
y.create.l HWIO_PCNOC_4_ABT_SYND_VALID_ADDR A:0x68801020
y.create.l HWIO_PCNOC_4_ABT_SYND_CLEAR_ADDR A:0x68801024
y.create.l HWIO_PCNOC_4_ABT_SYND_ID_ADDR A:0x68801028
y.create.l HWIO_PCNOC_4_ABT_SYND_ADDR0_ADDR A:0x6880102c
y.create.l HWIO_PCNOC_4_ABT_SYND_ADDR1_ADDR A:0x68801030
y.create.l HWIO_PCNOC_4_ABT_SYND_HREADY_ADDR A:0x68801034
y.create.l HWIO_PCNOC_5_ABT_HW_VERSION_ADDR A:0x60028000
y.create.l HWIO_PCNOC_5_ABT_INST_ID_ADDR A:0x60028004
y.create.l HWIO_PCNOC_5_ABT_NUM_SLAVES_ADDR A:0x60028008
y.create.l HWIO_PCNOC_5_ABT_TIMER_LOADVAL_ADDR A:0x6002800c
y.create.l HWIO_PCNOC_5_ABT_TIMER_MODE_ADDR A:0x60028010
y.create.l HWIO_PCNOC_5_ABT_INTR_STATUS_ADDR A:0x60028014
y.create.l HWIO_PCNOC_5_ABT_INTR_CLEAR_ADDR A:0x60028018
y.create.l HWIO_PCNOC_5_ABT_INTR_ENABLE_ADDR A:0x6002801c
y.create.l HWIO_PCNOC_5_ABT_SYND_VALID_ADDR A:0x60028020
y.create.l HWIO_PCNOC_5_ABT_SYND_CLEAR_ADDR A:0x60028024
y.create.l HWIO_PCNOC_5_ABT_SYND_ID_ADDR A:0x60028028
y.create.l HWIO_PCNOC_5_ABT_SYND_ADDR0_ADDR A:0x6002802c
y.create.l HWIO_PCNOC_5_ABT_SYND_ADDR1_ADDR A:0x60028030
y.create.l HWIO_PCNOC_5_ABT_SYND_HREADY_ADDR A:0x60028034
y.create.l HWIO_PCNOC_6_ABT_HW_VERSION_ADDR A:0x60029000
y.create.l HWIO_PCNOC_6_ABT_INST_ID_ADDR A:0x60029004
y.create.l HWIO_PCNOC_6_ABT_NUM_SLAVES_ADDR A:0x60029008
y.create.l HWIO_PCNOC_6_ABT_TIMER_LOADVAL_ADDR A:0x6002900c
y.create.l HWIO_PCNOC_6_ABT_TIMER_MODE_ADDR A:0x60029010
y.create.l HWIO_PCNOC_6_ABT_INTR_STATUS_ADDR A:0x60029014
y.create.l HWIO_PCNOC_6_ABT_INTR_CLEAR_ADDR A:0x60029018
y.create.l HWIO_PCNOC_6_ABT_INTR_ENABLE_ADDR A:0x6002901c
y.create.l HWIO_PCNOC_6_ABT_SYND_VALID_ADDR A:0x60029020
y.create.l HWIO_PCNOC_6_ABT_SYND_CLEAR_ADDR A:0x60029024
y.create.l HWIO_PCNOC_6_ABT_SYND_ID_ADDR A:0x60029028
y.create.l HWIO_PCNOC_6_ABT_SYND_ADDR0_ADDR A:0x6002902c
y.create.l HWIO_PCNOC_6_ABT_SYND_ADDR1_ADDR A:0x60029030
y.create.l HWIO_PCNOC_6_ABT_SYND_HREADY_ADDR A:0x60029034
y.create.l HWIO_PCNOC_7_ABT_HW_VERSION_ADDR A:0x6002a000
y.create.l HWIO_PCNOC_7_ABT_INST_ID_ADDR A:0x6002a004
y.create.l HWIO_PCNOC_7_ABT_NUM_SLAVES_ADDR A:0x6002a008
y.create.l HWIO_PCNOC_7_ABT_TIMER_LOADVAL_ADDR A:0x6002a00c
y.create.l HWIO_PCNOC_7_ABT_TIMER_MODE_ADDR A:0x6002a010
y.create.l HWIO_PCNOC_7_ABT_INTR_STATUS_ADDR A:0x6002a014
y.create.l HWIO_PCNOC_7_ABT_INTR_CLEAR_ADDR A:0x6002a018
y.create.l HWIO_PCNOC_7_ABT_INTR_ENABLE_ADDR A:0x6002a01c
y.create.l HWIO_PCNOC_7_ABT_SYND_VALID_ADDR A:0x6002a020
y.create.l HWIO_PCNOC_7_ABT_SYND_CLEAR_ADDR A:0x6002a024
y.create.l HWIO_PCNOC_7_ABT_SYND_ID_ADDR A:0x6002a028
y.create.l HWIO_PCNOC_7_ABT_SYND_ADDR0_ADDR A:0x6002a02c
y.create.l HWIO_PCNOC_7_ABT_SYND_ADDR1_ADDR A:0x6002a030
y.create.l HWIO_PCNOC_7_ABT_SYND_HREADY_ADDR A:0x6002a034
y.create.l HWIO_PCNOC_OBS_ID_COREID_ADDR A:0x60500000
y.create.l HWIO_PCNOC_OBS_ID_REVISIONID_ADDR A:0x60500004
y.create.l HWIO_PCNOC_OBS_FAULTEN_ADDR A:0x60500008
y.create.l HWIO_PCNOC_OBS_ERRVLD_ADDR A:0x6050000c
y.create.l HWIO_PCNOC_OBS_ERRCLR_ADDR A:0x60500010
y.create.l HWIO_PCNOC_OBS_ERRLOG0_ADDR A:0x60500014
y.create.l HWIO_PCNOC_OBS_ERRLOG1_ADDR A:0x60500018
y.create.l HWIO_PCNOC_OBS_ERRLOG2_ADDR A:0x6050001c
y.create.l HWIO_PCNOC_OBS_ERRLOG3_ADDR A:0x60500020
y.create.l HWIO_PCNOC_OBS_ERRLOG4_ADDR A:0x60500024
y.create.l HWIO_PCNOC_OBS_ERRLOG5_ADDR A:0x60500028
y.create.l HWIO_PCNOC_OBS_STALLEN_ADDR A:0x60500038
y.create.l HWIO_PCNOC_OBS_DBG_ID_COREID_ADDR A:0x60500080
y.create.l HWIO_PCNOC_OBS_DBG_ID_REVISIONID_ADDR A:0x60500084
y.create.l HWIO_PCNOC_OBS_DBG_ATBID_ADDR A:0x60500088
y.create.l HWIO_PCNOC_OBS_DBG_ATBEN_ADDR A:0x6050008c
y.create.l HWIO_PCNOC_OBS_DBG_SYNCPERIOD_ADDR A:0x60500090
y.create.l HWIO_PCNOC_QXM_CRYPTO0_TFILT_ID_COREID_ADDR A:0x60501000
y.create.l HWIO_PCNOC_QXM_CRYPTO0_TFILT_ID_REVISIONID_ADDR A:0x60501004
y.create.l HWIO_PCNOC_QXM_CRYPTO0_TFILT_MODE_ADDR A:0x60501008
y.create.l HWIO_PCNOC_QXM_CRYPTO0_TFILT_ADDRBASE_LOW_ADDR A:0x6050100c
y.create.l HWIO_PCNOC_QXM_CRYPTO0_TFILT_ADDRBASE_HIGH_ADDR A:0x60501010
y.create.l HWIO_PCNOC_QXM_CRYPTO0_TFILT_ADDRWINDOWSIZE_ADDR A:0x60501014
y.create.l HWIO_PCNOC_QXM_CRYPTO0_TFILT_SRCIDBASE_ADDR A:0x60501018
y.create.l HWIO_PCNOC_QXM_CRYPTO0_TFILT_SRCIDMASK_ADDR A:0x6050101c
y.create.l HWIO_PCNOC_QXM_CRYPTO0_TFILT_OPCODE_ADDR A:0x60501020
y.create.l HWIO_PCNOC_QXM_CRYPTO0_TFILT_USERBASE_ADDR A:0x60501024
y.create.l HWIO_PCNOC_QXM_CRYPTO0_TFILT_USERMASK_ADDR A:0x60501028
y.create.l HWIO_PCNOC_QXM_SDC1_TFILT_ID_COREID_ADDR A:0x60501080
y.create.l HWIO_PCNOC_QXM_SDC1_TFILT_ID_REVISIONID_ADDR A:0x60501084
y.create.l HWIO_PCNOC_QXM_SDC1_TFILT_MODE_ADDR A:0x60501088
y.create.l HWIO_PCNOC_QXM_SDC1_TFILT_ADDRBASE_LOW_ADDR A:0x6050108c
y.create.l HWIO_PCNOC_QXM_SDC1_TFILT_ADDRBASE_HIGH_ADDR A:0x60501090
y.create.l HWIO_PCNOC_QXM_SDC1_TFILT_ADDRWINDOWSIZE_ADDR A:0x60501094
y.create.l HWIO_PCNOC_QXM_SDC1_TFILT_SRCIDBASE_ADDR A:0x60501098
y.create.l HWIO_PCNOC_QXM_SDC1_TFILT_SRCIDMASK_ADDR A:0x6050109c
y.create.l HWIO_PCNOC_QXM_SDC1_TFILT_OPCODE_ADDR A:0x605010a0
y.create.l HWIO_PCNOC_QXM_SDC1_TFILT_USERBASE_ADDR A:0x605010a4
y.create.l HWIO_PCNOC_QXM_SDC1_TFILT_USERMASK_ADDR A:0x605010a8
y.create.l HWIO_PCNOC_QXM_SDC2_TFILT_ID_COREID_ADDR A:0x60501100
y.create.l HWIO_PCNOC_QXM_SDC2_TFILT_ID_REVISIONID_ADDR A:0x60501104
y.create.l HWIO_PCNOC_QXM_SDC2_TFILT_MODE_ADDR A:0x60501108
y.create.l HWIO_PCNOC_QXM_SDC2_TFILT_ADDRBASE_LOW_ADDR A:0x6050110c
y.create.l HWIO_PCNOC_QXM_SDC2_TFILT_ADDRBASE_HIGH_ADDR A:0x60501110
y.create.l HWIO_PCNOC_QXM_SDC2_TFILT_ADDRWINDOWSIZE_ADDR A:0x60501114
y.create.l HWIO_PCNOC_QXM_SDC2_TFILT_SRCIDBASE_ADDR A:0x60501118
y.create.l HWIO_PCNOC_QXM_SDC2_TFILT_SRCIDMASK_ADDR A:0x6050111c
y.create.l HWIO_PCNOC_QXM_SDC2_TFILT_OPCODE_ADDR A:0x60501120
y.create.l HWIO_PCNOC_QXM_SDC2_TFILT_USERBASE_ADDR A:0x60501124
y.create.l HWIO_PCNOC_QXM_SDC2_TFILT_USERMASK_ADDR A:0x60501128
y.create.l HWIO_PCNOC_QHM2_TFILT_ID_COREID_ADDR A:0x60501180
y.create.l HWIO_PCNOC_QHM2_TFILT_ID_REVISIONID_ADDR A:0x60501184
y.create.l HWIO_PCNOC_QHM2_TFILT_MODE_ADDR A:0x60501188
y.create.l HWIO_PCNOC_QHM2_TFILT_ADDRBASE_LOW_ADDR A:0x6050118c
y.create.l HWIO_PCNOC_QHM2_TFILT_ADDRWINDOWSIZE_ADDR A:0x60501194
y.create.l HWIO_PCNOC_QHM2_TFILT_SRCIDBASE_ADDR A:0x60501198
y.create.l HWIO_PCNOC_QHM2_TFILT_SRCIDMASK_ADDR A:0x6050119c
y.create.l HWIO_PCNOC_QHM2_TFILT_OPCODE_ADDR A:0x605011a0
y.create.l HWIO_PCNOC_QHM2_TFILT_USERBASE_ADDR A:0x605011a4
y.create.l HWIO_PCNOC_QHM2_TFILT_USERMASK_ADDR A:0x605011a8
y.create.l HWIO_PCNOC_QHM1_TFILT_ID_COREID_ADDR A:0x60501200
y.create.l HWIO_PCNOC_QHM1_TFILT_ID_REVISIONID_ADDR A:0x60501204
y.create.l HWIO_PCNOC_QHM1_TFILT_MODE_ADDR A:0x60501208
y.create.l HWIO_PCNOC_QHM1_TFILT_ADDRBASE_LOW_ADDR A:0x6050120c
y.create.l HWIO_PCNOC_QHM1_TFILT_ADDRWINDOWSIZE_ADDR A:0x60501214
y.create.l HWIO_PCNOC_QHM1_TFILT_SRCIDBASE_ADDR A:0x60501218
y.create.l HWIO_PCNOC_QHM1_TFILT_SRCIDMASK_ADDR A:0x6050121c
y.create.l HWIO_PCNOC_QHM1_TFILT_OPCODE_ADDR A:0x60501220
y.create.l HWIO_PCNOC_QHM1_TFILT_USERBASE_ADDR A:0x60501224
y.create.l HWIO_PCNOC_QHM1_TFILT_USERMASK_ADDR A:0x60501228
y.create.l HWIO_PCNOC_QXM_BIMC_TFILT_ID_COREID_ADDR A:0x60501280
y.create.l HWIO_PCNOC_QXM_BIMC_TFILT_ID_REVISIONID_ADDR A:0x60501284
y.create.l HWIO_PCNOC_QXM_BIMC_TFILT_MODE_ADDR A:0x60501288
y.create.l HWIO_PCNOC_QXM_BIMC_TFILT_ADDRBASE_LOW_ADDR A:0x6050128c
y.create.l HWIO_PCNOC_QXM_BIMC_TFILT_ADDRBASE_HIGH_ADDR A:0x60501290
y.create.l HWIO_PCNOC_QXM_BIMC_TFILT_ADDRWINDOWSIZE_ADDR A:0x60501294
y.create.l HWIO_PCNOC_QXM_BIMC_TFILT_SRCIDBASE_ADDR A:0x60501298
y.create.l HWIO_PCNOC_QXM_BIMC_TFILT_SRCIDMASK_ADDR A:0x6050129c
y.create.l HWIO_PCNOC_QXM_BIMC_TFILT_OPCODE_ADDR A:0x605012a0
y.create.l HWIO_PCNOC_QXM_BIMC_TFILT_USERBASE_ADDR A:0x605012a4
y.create.l HWIO_PCNOC_QXM_BIMC_TFILT_USERMASK_ADDR A:0x605012a8
y.create.l HWIO_PCNOC_QDSS_BAM_TFILT_ID_COREID_ADDR A:0x60501300
y.create.l HWIO_PCNOC_QDSS_BAM_TFILT_ID_REVISIONID_ADDR A:0x60501304
y.create.l HWIO_PCNOC_QDSS_BAM_TFILT_MODE_ADDR A:0x60501308
y.create.l HWIO_PCNOC_QDSS_BAM_TFILT_ADDRBASE_LOW_ADDR A:0x6050130c
y.create.l HWIO_PCNOC_QDSS_BAM_TFILT_ADDRWINDOWSIZE_ADDR A:0x60501314
y.create.l HWIO_PCNOC_QDSS_BAM_TFILT_SRCIDBASE_ADDR A:0x60501318
y.create.l HWIO_PCNOC_QDSS_BAM_TFILT_SRCIDMASK_ADDR A:0x6050131c
y.create.l HWIO_PCNOC_QDSS_BAM_TFILT_OPCODE_ADDR A:0x60501320
y.create.l HWIO_PCNOC_QDSS_BAM_TFILT_USERBASE_ADDR A:0x60501324
y.create.l HWIO_PCNOC_QDSS_BAM_TFILT_USERMASK_ADDR A:0x60501328
y.create.l HWIO_PCNOC_HSIC_TFILT_ID_COREID_ADDR A:0x60501380
y.create.l HWIO_PCNOC_HSIC_TFILT_ID_REVISIONID_ADDR A:0x60501384
y.create.l HWIO_PCNOC_HSIC_TFILT_MODE_ADDR A:0x60501388
y.create.l HWIO_PCNOC_HSIC_TFILT_ADDRBASE_LOW_ADDR A:0x6050138c
y.create.l HWIO_PCNOC_HSIC_TFILT_ADDRWINDOWSIZE_ADDR A:0x60501394
y.create.l HWIO_PCNOC_HSIC_TFILT_SRCIDBASE_ADDR A:0x60501398
y.create.l HWIO_PCNOC_HSIC_TFILT_SRCIDMASK_ADDR A:0x6050139c
y.create.l HWIO_PCNOC_HSIC_TFILT_OPCODE_ADDR A:0x605013a0
y.create.l HWIO_PCNOC_HSIC_TFILT_USERBASE_ADDR A:0x605013a4
y.create.l HWIO_PCNOC_HSIC_TFILT_USERMASK_ADDR A:0x605013a8
y.create.l HWIO_PCNOC_SGMI_TFILT_ID_COREID_ADDR A:0x60501400
y.create.l HWIO_PCNOC_SGMI_TFILT_ID_REVISIONID_ADDR A:0x60501404
y.create.l HWIO_PCNOC_SGMI_TFILT_MODE_ADDR A:0x60501408
y.create.l HWIO_PCNOC_SGMI_TFILT_ADDRBASE_LOW_ADDR A:0x6050140c
y.create.l HWIO_PCNOC_SGMI_TFILT_ADDRWINDOWSIZE_ADDR A:0x60501414
y.create.l HWIO_PCNOC_SGMI_TFILT_SRCIDBASE_ADDR A:0x60501418
y.create.l HWIO_PCNOC_SGMI_TFILT_SRCIDMASK_ADDR A:0x6050141c
y.create.l HWIO_PCNOC_SGMI_TFILT_OPCODE_ADDR A:0x60501420
y.create.l HWIO_PCNOC_SGMI_TFILT_USERBASE_ADDR A:0x60501424
y.create.l HWIO_PCNOC_SGMI_TFILT_USERMASK_ADDR A:0x60501428
y.create.l HWIO_PCNOC_USB_HS1_TFILT_ID_COREID_ADDR A:0x60501480
y.create.l HWIO_PCNOC_USB_HS1_TFILT_ID_REVISIONID_ADDR A:0x60501484
y.create.l HWIO_PCNOC_USB_HS1_TFILT_MODE_ADDR A:0x60501488
y.create.l HWIO_PCNOC_USB_HS1_TFILT_ADDRBASE_LOW_ADDR A:0x6050148c
y.create.l HWIO_PCNOC_USB_HS1_TFILT_ADDRWINDOWSIZE_ADDR A:0x60501494
y.create.l HWIO_PCNOC_USB_HS1_TFILT_SRCIDBASE_ADDR A:0x60501498
y.create.l HWIO_PCNOC_USB_HS1_TFILT_SRCIDMASK_ADDR A:0x6050149c
y.create.l HWIO_PCNOC_USB_HS1_TFILT_OPCODE_ADDR A:0x605014a0
y.create.l HWIO_PCNOC_USB_HS1_TFILT_USERBASE_ADDR A:0x605014a4
y.create.l HWIO_PCNOC_USB_HS1_TFILT_USERMASK_ADDR A:0x605014a8
y.create.l HWIO_PCNOC_QXM_NOC_TFILT_ID_COREID_ADDR A:0x60501500
y.create.l HWIO_PCNOC_QXM_NOC_TFILT_ID_REVISIONID_ADDR A:0x60501504
y.create.l HWIO_PCNOC_QXM_NOC_TFILT_MODE_ADDR A:0x60501508
y.create.l HWIO_PCNOC_QXM_NOC_TFILT_ADDRBASE_LOW_ADDR A:0x6050150c
y.create.l HWIO_PCNOC_QXM_NOC_TFILT_ADDRBASE_HIGH_ADDR A:0x60501510
y.create.l HWIO_PCNOC_QXM_NOC_TFILT_ADDRWINDOWSIZE_ADDR A:0x60501514
y.create.l HWIO_PCNOC_QXM_NOC_TFILT_SRCIDBASE_ADDR A:0x60501518
y.create.l HWIO_PCNOC_QXM_NOC_TFILT_SRCIDMASK_ADDR A:0x6050151c
y.create.l HWIO_PCNOC_QXM_NOC_TFILT_OPCODE_ADDR A:0x60501520
y.create.l HWIO_PCNOC_QXM_NOC_TFILT_USERBASE_ADDR A:0x60501524
y.create.l HWIO_PCNOC_QXM_NOC_TFILT_USERMASK_ADDR A:0x60501528
y.create.l HWIO_PCNOC_QDSS_ETR_TFILT_ID_COREID_ADDR A:0x60501580
y.create.l HWIO_PCNOC_QDSS_ETR_TFILT_ID_REVISIONID_ADDR A:0x60501584
y.create.l HWIO_PCNOC_QDSS_ETR_TFILT_MODE_ADDR A:0x60501588
y.create.l HWIO_PCNOC_QDSS_ETR_TFILT_ADDRBASE_LOW_ADDR A:0x6050158c
y.create.l HWIO_PCNOC_QDSS_ETR_TFILT_ADDRWINDOWSIZE_ADDR A:0x60501594
y.create.l HWIO_PCNOC_QDSS_ETR_TFILT_SRCIDBASE_ADDR A:0x60501598
y.create.l HWIO_PCNOC_QDSS_ETR_TFILT_SRCIDMASK_ADDR A:0x6050159c
y.create.l HWIO_PCNOC_QDSS_ETR_TFILT_OPCODE_ADDR A:0x605015a0
y.create.l HWIO_PCNOC_QDSS_ETR_TFILT_USERBASE_ADDR A:0x605015a4
y.create.l HWIO_PCNOC_QDSS_ETR_TFILT_USERMASK_ADDR A:0x605015a8
y.create.l HWIO_PCNOC_TPRB0_TPROF_ID_COREID_ADDR A:0x60502000
y.create.l HWIO_PCNOC_TPRB0_TPROF_ID_REVISIONID_ADDR A:0x60502004
y.create.l HWIO_PCNOC_TPRB0_TPROF_EN_ADDR A:0x60502008
y.create.l HWIO_PCNOC_TPRB0_TPROF_MODE_ADDR A:0x6050200c
y.create.l HWIO_PCNOC_TPRB0_TPROF_OBSERVEDSEL_0_ADDR A:0x60502010
y.create.l HWIO_PCNOC_TPRB0_TPROF_OBSERVEDSEL_1_ADDR A:0x60502014
y.create.l HWIO_PCNOC_TPRB0_TPROF_NTENURELINES_0_ADDR A:0x60502020
y.create.l HWIO_PCNOC_TPRB0_TPROF_THRESHOLDS_0_0_ADDR A:0x6050202c
y.create.l HWIO_PCNOC_TPRB0_TPROF_THRESHOLDS_0_1_ADDR A:0x60502030
y.create.l HWIO_PCNOC_TPRB0_TPROF_THRESHOLDS_0_2_ADDR A:0x60502034
y.create.l HWIO_PCNOC_TPRB0_TPROF_THRESHOLDS_1_0_ADDR A:0x6050203c
y.create.l HWIO_PCNOC_TPRB0_TPROF_THRESHOLDS_1_1_ADDR A:0x60502040
y.create.l HWIO_PCNOC_TPRB0_TPROF_THRESHOLDS_1_2_ADDR A:0x60502044
y.create.l HWIO_PCNOC_TPRB0_TPROF_OVERFLOWSTATUS_ADDR A:0x6050206c
y.create.l HWIO_PCNOC_TPRB0_TPROF_OVERFLOWRESET_ADDR A:0x60502070
y.create.l HWIO_PCNOC_TPRB0_TPROF_PENDINGEVENTMODE_ADDR A:0x60502074
y.create.l HWIO_PCNOC_TPRB0_TPROF_PRESCALER_ADDR A:0x60502078
y.create.l HWIO_PCNOC_TPRB1_TPROF_ID_COREID_ADDR A:0x60502080
y.create.l HWIO_PCNOC_TPRB1_TPROF_ID_REVISIONID_ADDR A:0x60502084
y.create.l HWIO_PCNOC_TPRB1_TPROF_EN_ADDR A:0x60502088
y.create.l HWIO_PCNOC_TPRB1_TPROF_MODE_ADDR A:0x6050208c
y.create.l HWIO_PCNOC_TPRB1_TPROF_OBSERVEDSEL_0_ADDR A:0x60502090
y.create.l HWIO_PCNOC_TPRB1_TPROF_OBSERVEDSEL_1_ADDR A:0x60502094
y.create.l HWIO_PCNOC_TPRB1_TPROF_NTENURELINES_0_ADDR A:0x605020a0
y.create.l HWIO_PCNOC_TPRB1_TPROF_THRESHOLDS_0_0_ADDR A:0x605020ac
y.create.l HWIO_PCNOC_TPRB1_TPROF_THRESHOLDS_0_1_ADDR A:0x605020b0
y.create.l HWIO_PCNOC_TPRB1_TPROF_THRESHOLDS_0_2_ADDR A:0x605020b4
y.create.l HWIO_PCNOC_TPRB1_TPROF_THRESHOLDS_1_0_ADDR A:0x605020bc
y.create.l HWIO_PCNOC_TPRB1_TPROF_THRESHOLDS_1_1_ADDR A:0x605020c0
y.create.l HWIO_PCNOC_TPRB1_TPROF_THRESHOLDS_1_2_ADDR A:0x605020c4
y.create.l HWIO_PCNOC_TPRB1_TPROF_OVERFLOWSTATUS_ADDR A:0x605020ec
y.create.l HWIO_PCNOC_TPRB1_TPROF_OVERFLOWRESET_ADDR A:0x605020f0
y.create.l HWIO_PCNOC_TPRB1_TPROF_PENDINGEVENTMODE_ADDR A:0x605020f4
y.create.l HWIO_PCNOC_TPRB1_TPROF_PRESCALER_ADDR A:0x605020f8
y.create.l HWIO_PCNOC_EPRB0_SPROF_ID_COREID_ADDR A:0x60503000
y.create.l HWIO_PCNOC_EPRB0_SPROF_ID_REVISIONID_ADDR A:0x60503004
y.create.l HWIO_PCNOC_EPRB0_SPROF_MAINCTL_ADDR A:0x60503008
y.create.l HWIO_PCNOC_EPRB0_SPROF_CFGCTL_ADDR A:0x6050300c
y.create.l HWIO_PCNOC_EPRB0_SPROF_TRACEPORTSEL_ADDR A:0x60503010
y.create.l HWIO_PCNOC_EPRB0_SPROF_FILTERLUT_ADDR A:0x60503014
y.create.l HWIO_PCNOC_EPRB0_SPROF_TRACEALARMEN_ADDR A:0x60503018
y.create.l HWIO_PCNOC_EPRB0_SPROF_TRACEALARMSTATUS_ADDR A:0x6050301c
y.create.l HWIO_PCNOC_EPRB0_SPROF_TRACEALARMCLR_ADDR A:0x60503020
y.create.l HWIO_PCNOC_EPRB0_SPROF_STATPERIOD_ADDR A:0x60503024
y.create.l HWIO_PCNOC_EPRB0_SPROF_STATGO_ADDR A:0x60503028
y.create.l HWIO_PCNOC_EPRB0_SPROF_STATALARMMIN_ADDR A:0x6050302c
y.create.l HWIO_PCNOC_EPRB0_SPROF_STATALARMMAX_ADDR A:0x60503030
y.create.l HWIO_PCNOC_EPRB0_SPROF_STATALARMSTATUS_ADDR A:0x60503034
y.create.l HWIO_PCNOC_EPRB0_SPROF_STATALARMCLR_ADDR A:0x60503038
y.create.l HWIO_PCNOC_EPRB0_SPROF_STATALARMEN_ADDR A:0x6050303c
y.create.l HWIO_PCNOC_EPRB0_SPROF_FILTERS_0_ROUTEIDBASE_ADDR A:0x60503044
y.create.l HWIO_PCNOC_EPRB0_SPROF_FILTERS_0_ROUTEIDMASK_ADDR A:0x60503048
y.create.l HWIO_PCNOC_EPRB0_SPROF_FILTERS_0_ADDRBASE_LOW_ADDR A:0x6050304c
y.create.l HWIO_PCNOC_EPRB0_SPROF_FILTERS_0_ADDRBASE_HIGH_ADDR A:0x60503050
y.create.l HWIO_PCNOC_EPRB0_SPROF_FILTERS_0_WINDOWSIZE_ADDR A:0x60503054
y.create.l HWIO_PCNOC_EPRB0_SPROF_FILTERS_0_OPCODE_ADDR A:0x60503060
y.create.l HWIO_PCNOC_EPRB0_SPROF_FILTERS_0_STATUS_ADDR A:0x60503064
y.create.l HWIO_PCNOC_EPRB0_SPROF_FILTERS_0_LENGTH_ADDR A:0x60503068
y.create.l HWIO_PCNOC_EPRB0_SPROF_FILTERS_0_URGENCY_ADDR A:0x6050306c
y.create.l HWIO_PCNOC_EPRB0_SPROF_FILTERS_1_ROUTEIDBASE_ADDR A:0x60503080
y.create.l HWIO_PCNOC_EPRB0_SPROF_FILTERS_1_ROUTEIDMASK_ADDR A:0x60503084
y.create.l HWIO_PCNOC_EPRB0_SPROF_FILTERS_1_ADDRBASE_LOW_ADDR A:0x60503088
y.create.l HWIO_PCNOC_EPRB0_SPROF_FILTERS_1_ADDRBASE_HIGH_ADDR A:0x6050308c
y.create.l HWIO_PCNOC_EPRB0_SPROF_FILTERS_1_WINDOWSIZE_ADDR A:0x60503090
y.create.l HWIO_PCNOC_EPRB0_SPROF_FILTERS_1_OPCODE_ADDR A:0x6050309c
y.create.l HWIO_PCNOC_EPRB0_SPROF_FILTERS_1_STATUS_ADDR A:0x605030a0
y.create.l HWIO_PCNOC_EPRB0_SPROF_FILTERS_1_LENGTH_ADDR A:0x605030a4
y.create.l HWIO_PCNOC_EPRB0_SPROF_FILTERS_1_URGENCY_ADDR A:0x605030a8
y.create.l HWIO_PCNOC_EPRB0_SPROF_FILTERS_2_ROUTEIDBASE_ADDR A:0x605030bc
y.create.l HWIO_PCNOC_EPRB0_SPROF_FILTERS_2_ROUTEIDMASK_ADDR A:0x605030c0
y.create.l HWIO_PCNOC_EPRB0_SPROF_FILTERS_2_ADDRBASE_LOW_ADDR A:0x605030c4
y.create.l HWIO_PCNOC_EPRB0_SPROF_FILTERS_2_ADDRBASE_HIGH_ADDR A:0x605030c8
y.create.l HWIO_PCNOC_EPRB0_SPROF_FILTERS_2_WINDOWSIZE_ADDR A:0x605030cc
y.create.l HWIO_PCNOC_EPRB0_SPROF_FILTERS_2_OPCODE_ADDR A:0x605030d8
y.create.l HWIO_PCNOC_EPRB0_SPROF_FILTERS_2_STATUS_ADDR A:0x605030dc
y.create.l HWIO_PCNOC_EPRB0_SPROF_FILTERS_2_LENGTH_ADDR A:0x605030e0
y.create.l HWIO_PCNOC_EPRB0_SPROF_FILTERS_2_URGENCY_ADDR A:0x605030e4
y.create.l HWIO_PCNOC_EPRB0_SPROF_FILTERS_3_ROUTEIDBASE_ADDR A:0x605030f8
y.create.l HWIO_PCNOC_EPRB0_SPROF_FILTERS_3_ROUTEIDMASK_ADDR A:0x605030fc
y.create.l HWIO_PCNOC_EPRB0_SPROF_FILTERS_3_ADDRBASE_LOW_ADDR A:0x60503100
y.create.l HWIO_PCNOC_EPRB0_SPROF_FILTERS_3_ADDRBASE_HIGH_ADDR A:0x60503104
y.create.l HWIO_PCNOC_EPRB0_SPROF_FILTERS_3_WINDOWSIZE_ADDR A:0x60503108
y.create.l HWIO_PCNOC_EPRB0_SPROF_FILTERS_3_OPCODE_ADDR A:0x60503114
y.create.l HWIO_PCNOC_EPRB0_SPROF_FILTERS_3_STATUS_ADDR A:0x60503118
y.create.l HWIO_PCNOC_EPRB0_SPROF_FILTERS_3_LENGTH_ADDR A:0x6050311c
y.create.l HWIO_PCNOC_EPRB0_SPROF_FILTERS_3_URGENCY_ADDR A:0x60503120
y.create.l HWIO_PCNOC_EPRB0_SPROF_COUNTERS_0_PORTSEL_ADDR A:0x60503134
y.create.l HWIO_PCNOC_EPRB0_SPROF_COUNTERS_0_SRC_ADDR A:0x60503138
y.create.l HWIO_PCNOC_EPRB0_SPROF_COUNTERS_0_ALARMMODE_ADDR A:0x6050313c
y.create.l HWIO_PCNOC_EPRB0_SPROF_COUNTERS_0_VAL_ADDR A:0x60503140
y.create.l HWIO_PCNOC_EPRB0_SPROF_COUNTERS_1_PORTSEL_ADDR A:0x60503148
y.create.l HWIO_PCNOC_EPRB0_SPROF_COUNTERS_1_SRC_ADDR A:0x6050314c
y.create.l HWIO_PCNOC_EPRB0_SPROF_COUNTERS_1_ALARMMODE_ADDR A:0x60503150
y.create.l HWIO_PCNOC_EPRB0_SPROF_COUNTERS_1_VAL_ADDR A:0x60503154
y.create.l HWIO_PCNOC_EPRB0_SPROF_COUNTERS_2_PORTSEL_ADDR A:0x6050315c
y.create.l HWIO_PCNOC_EPRB0_SPROF_COUNTERS_2_SRC_ADDR A:0x60503160
y.create.l HWIO_PCNOC_EPRB0_SPROF_COUNTERS_2_ALARMMODE_ADDR A:0x60503164
y.create.l HWIO_PCNOC_EPRB0_SPROF_COUNTERS_2_VAL_ADDR A:0x60503168
y.create.l HWIO_PCNOC_EPRB0_SPROF_COUNTERS_3_PORTSEL_ADDR A:0x60503170
y.create.l HWIO_PCNOC_EPRB0_SPROF_COUNTERS_3_SRC_ADDR A:0x60503174
y.create.l HWIO_PCNOC_EPRB0_SPROF_COUNTERS_3_ALARMMODE_ADDR A:0x60503178
y.create.l HWIO_PCNOC_EPRB0_SPROF_COUNTERS_3_VAL_ADDR A:0x6050317c
y.create.l HWIO_PCNOC_EPRB0_SPROF_COUNTERS_4_PORTSEL_ADDR A:0x60503184
y.create.l HWIO_PCNOC_EPRB0_SPROF_COUNTERS_4_SRC_ADDR A:0x60503188
y.create.l HWIO_PCNOC_EPRB0_SPROF_COUNTERS_4_ALARMMODE_ADDR A:0x6050318c
y.create.l HWIO_PCNOC_EPRB0_SPROF_COUNTERS_4_VAL_ADDR A:0x60503190
y.create.l HWIO_PCNOC_EPRB0_SPROF_COUNTERS_5_PORTSEL_ADDR A:0x60503198
y.create.l HWIO_PCNOC_EPRB0_SPROF_COUNTERS_5_SRC_ADDR A:0x6050319c
y.create.l HWIO_PCNOC_EPRB0_SPROF_COUNTERS_5_ALARMMODE_ADDR A:0x605031a0
y.create.l HWIO_PCNOC_EPRB0_SPROF_COUNTERS_5_VAL_ADDR A:0x605031a4
y.create.l HWIO_PCNOC_EPRB0_SPROF_COUNTERS_6_PORTSEL_ADDR A:0x605031ac
y.create.l HWIO_PCNOC_EPRB0_SPROF_COUNTERS_6_SRC_ADDR A:0x605031b0
y.create.l HWIO_PCNOC_EPRB0_SPROF_COUNTERS_6_ALARMMODE_ADDR A:0x605031b4
y.create.l HWIO_PCNOC_EPRB0_SPROF_COUNTERS_6_VAL_ADDR A:0x605031b8
y.create.l HWIO_PCNOC_EPRB0_SPROF_COUNTERS_7_PORTSEL_ADDR A:0x605031c0
y.create.l HWIO_PCNOC_EPRB0_SPROF_COUNTERS_7_SRC_ADDR A:0x605031c4
y.create.l HWIO_PCNOC_EPRB0_SPROF_COUNTERS_7_ALARMMODE_ADDR A:0x605031c8
y.create.l HWIO_PCNOC_EPRB0_SPROF_COUNTERS_7_VAL_ADDR A:0x605031cc
y.create.l HWIO_PCNOC_EPRB0_SPROF_COUNTERS_8_PORTSEL_ADDR A:0x605031d4
y.create.l HWIO_PCNOC_EPRB0_SPROF_COUNTERS_8_SRC_ADDR A:0x605031d8
y.create.l HWIO_PCNOC_EPRB0_SPROF_COUNTERS_8_ALARMMODE_ADDR A:0x605031dc
y.create.l HWIO_PCNOC_EPRB0_SPROF_COUNTERS_8_VAL_ADDR A:0x605031e0
y.create.l HWIO_PCNOC_EPRB0_SPROF_COUNTERS_9_PORTSEL_ADDR A:0x605031e8
y.create.l HWIO_PCNOC_EPRB0_SPROF_COUNTERS_9_SRC_ADDR A:0x605031ec
y.create.l HWIO_PCNOC_EPRB0_SPROF_COUNTERS_9_ALARMMODE_ADDR A:0x605031f0
y.create.l HWIO_PCNOC_EPRB0_SPROF_COUNTERS_9_VAL_ADDR A:0x605031f4
y.create.l HWIO_PCNOC_EPRB1_SPROF_ID_COREID_ADDR A:0x60503400
y.create.l HWIO_PCNOC_EPRB1_SPROF_ID_REVISIONID_ADDR A:0x60503404
y.create.l HWIO_PCNOC_EPRB1_SPROF_MAINCTL_ADDR A:0x60503408
y.create.l HWIO_PCNOC_EPRB1_SPROF_CFGCTL_ADDR A:0x6050340c
y.create.l HWIO_PCNOC_EPRB1_SPROF_TRACEPORTSEL_ADDR A:0x60503410
y.create.l HWIO_PCNOC_EPRB1_SPROF_FILTERLUT_ADDR A:0x60503414
y.create.l HWIO_PCNOC_EPRB1_SPROF_TRACEALARMEN_ADDR A:0x60503418
y.create.l HWIO_PCNOC_EPRB1_SPROF_TRACEALARMSTATUS_ADDR A:0x6050341c
y.create.l HWIO_PCNOC_EPRB1_SPROF_TRACEALARMCLR_ADDR A:0x60503420
y.create.l HWIO_PCNOC_EPRB1_SPROF_STATPERIOD_ADDR A:0x60503424
y.create.l HWIO_PCNOC_EPRB1_SPROF_STATGO_ADDR A:0x60503428
y.create.l HWIO_PCNOC_EPRB1_SPROF_STATALARMMIN_ADDR A:0x6050342c
y.create.l HWIO_PCNOC_EPRB1_SPROF_STATALARMMAX_ADDR A:0x60503430
y.create.l HWIO_PCNOC_EPRB1_SPROF_STATALARMSTATUS_ADDR A:0x60503434
y.create.l HWIO_PCNOC_EPRB1_SPROF_STATALARMCLR_ADDR A:0x60503438
y.create.l HWIO_PCNOC_EPRB1_SPROF_STATALARMEN_ADDR A:0x6050343c
y.create.l HWIO_PCNOC_EPRB1_SPROF_FILTERS_0_ROUTEIDBASE_ADDR A:0x60503444
y.create.l HWIO_PCNOC_EPRB1_SPROF_FILTERS_0_ROUTEIDMASK_ADDR A:0x60503448
y.create.l HWIO_PCNOC_EPRB1_SPROF_FILTERS_0_ADDRBASE_LOW_ADDR A:0x6050344c
y.create.l HWIO_PCNOC_EPRB1_SPROF_FILTERS_0_ADDRBASE_HIGH_ADDR A:0x60503450
y.create.l HWIO_PCNOC_EPRB1_SPROF_FILTERS_0_WINDOWSIZE_ADDR A:0x60503454
y.create.l HWIO_PCNOC_EPRB1_SPROF_FILTERS_0_OPCODE_ADDR A:0x60503460
y.create.l HWIO_PCNOC_EPRB1_SPROF_FILTERS_0_STATUS_ADDR A:0x60503464
y.create.l HWIO_PCNOC_EPRB1_SPROF_FILTERS_0_LENGTH_ADDR A:0x60503468
y.create.l HWIO_PCNOC_EPRB1_SPROF_FILTERS_0_URGENCY_ADDR A:0x6050346c
y.create.l HWIO_PCNOC_EPRB1_SPROF_FILTERS_1_ROUTEIDBASE_ADDR A:0x60503480
y.create.l HWIO_PCNOC_EPRB1_SPROF_FILTERS_1_ROUTEIDMASK_ADDR A:0x60503484
y.create.l HWIO_PCNOC_EPRB1_SPROF_FILTERS_1_ADDRBASE_LOW_ADDR A:0x60503488
y.create.l HWIO_PCNOC_EPRB1_SPROF_FILTERS_1_ADDRBASE_HIGH_ADDR A:0x6050348c
y.create.l HWIO_PCNOC_EPRB1_SPROF_FILTERS_1_WINDOWSIZE_ADDR A:0x60503490
y.create.l HWIO_PCNOC_EPRB1_SPROF_FILTERS_1_OPCODE_ADDR A:0x6050349c
y.create.l HWIO_PCNOC_EPRB1_SPROF_FILTERS_1_STATUS_ADDR A:0x605034a0
y.create.l HWIO_PCNOC_EPRB1_SPROF_FILTERS_1_LENGTH_ADDR A:0x605034a4
y.create.l HWIO_PCNOC_EPRB1_SPROF_FILTERS_1_URGENCY_ADDR A:0x605034a8
y.create.l HWIO_PCNOC_EPRB1_SPROF_FILTERS_2_ROUTEIDBASE_ADDR A:0x605034bc
y.create.l HWIO_PCNOC_EPRB1_SPROF_FILTERS_2_ROUTEIDMASK_ADDR A:0x605034c0
y.create.l HWIO_PCNOC_EPRB1_SPROF_FILTERS_2_ADDRBASE_LOW_ADDR A:0x605034c4
y.create.l HWIO_PCNOC_EPRB1_SPROF_FILTERS_2_ADDRBASE_HIGH_ADDR A:0x605034c8
y.create.l HWIO_PCNOC_EPRB1_SPROF_FILTERS_2_WINDOWSIZE_ADDR A:0x605034cc
y.create.l HWIO_PCNOC_EPRB1_SPROF_FILTERS_2_OPCODE_ADDR A:0x605034d8
y.create.l HWIO_PCNOC_EPRB1_SPROF_FILTERS_2_STATUS_ADDR A:0x605034dc
y.create.l HWIO_PCNOC_EPRB1_SPROF_FILTERS_2_LENGTH_ADDR A:0x605034e0
y.create.l HWIO_PCNOC_EPRB1_SPROF_FILTERS_2_URGENCY_ADDR A:0x605034e4
y.create.l HWIO_PCNOC_EPRB1_SPROF_FILTERS_3_ROUTEIDBASE_ADDR A:0x605034f8
y.create.l HWIO_PCNOC_EPRB1_SPROF_FILTERS_3_ROUTEIDMASK_ADDR A:0x605034fc
y.create.l HWIO_PCNOC_EPRB1_SPROF_FILTERS_3_ADDRBASE_LOW_ADDR A:0x60503500
y.create.l HWIO_PCNOC_EPRB1_SPROF_FILTERS_3_ADDRBASE_HIGH_ADDR A:0x60503504
y.create.l HWIO_PCNOC_EPRB1_SPROF_FILTERS_3_WINDOWSIZE_ADDR A:0x60503508
y.create.l HWIO_PCNOC_EPRB1_SPROF_FILTERS_3_OPCODE_ADDR A:0x60503514
y.create.l HWIO_PCNOC_EPRB1_SPROF_FILTERS_3_STATUS_ADDR A:0x60503518
y.create.l HWIO_PCNOC_EPRB1_SPROF_FILTERS_3_LENGTH_ADDR A:0x6050351c
y.create.l HWIO_PCNOC_EPRB1_SPROF_FILTERS_3_URGENCY_ADDR A:0x60503520
y.create.l HWIO_PCNOC_EPRB1_SPROF_COUNTERS_0_PORTSEL_ADDR A:0x60503534
y.create.l HWIO_PCNOC_EPRB1_SPROF_COUNTERS_0_SRC_ADDR A:0x60503538
y.create.l HWIO_PCNOC_EPRB1_SPROF_COUNTERS_0_ALARMMODE_ADDR A:0x6050353c
y.create.l HWIO_PCNOC_EPRB1_SPROF_COUNTERS_0_VAL_ADDR A:0x60503540
y.create.l HWIO_PCNOC_EPRB1_SPROF_COUNTERS_1_PORTSEL_ADDR A:0x60503548
y.create.l HWIO_PCNOC_EPRB1_SPROF_COUNTERS_1_SRC_ADDR A:0x6050354c
y.create.l HWIO_PCNOC_EPRB1_SPROF_COUNTERS_1_ALARMMODE_ADDR A:0x60503550
y.create.l HWIO_PCNOC_EPRB1_SPROF_COUNTERS_1_VAL_ADDR A:0x60503554
y.create.l HWIO_PCNOC_EPRB1_SPROF_COUNTERS_2_PORTSEL_ADDR A:0x6050355c
y.create.l HWIO_PCNOC_EPRB1_SPROF_COUNTERS_2_SRC_ADDR A:0x60503560
y.create.l HWIO_PCNOC_EPRB1_SPROF_COUNTERS_2_ALARMMODE_ADDR A:0x60503564
y.create.l HWIO_PCNOC_EPRB1_SPROF_COUNTERS_2_VAL_ADDR A:0x60503568
y.create.l HWIO_PCNOC_EPRB1_SPROF_COUNTERS_3_PORTSEL_ADDR A:0x60503570
y.create.l HWIO_PCNOC_EPRB1_SPROF_COUNTERS_3_SRC_ADDR A:0x60503574
y.create.l HWIO_PCNOC_EPRB1_SPROF_COUNTERS_3_ALARMMODE_ADDR A:0x60503578
y.create.l HWIO_PCNOC_EPRB1_SPROF_COUNTERS_3_VAL_ADDR A:0x6050357c
y.create.l HWIO_PCNOC_EPRB1_SPROF_COUNTERS_4_PORTSEL_ADDR A:0x60503584
y.create.l HWIO_PCNOC_EPRB1_SPROF_COUNTERS_4_SRC_ADDR A:0x60503588
y.create.l HWIO_PCNOC_EPRB1_SPROF_COUNTERS_4_ALARMMODE_ADDR A:0x6050358c
y.create.l HWIO_PCNOC_EPRB1_SPROF_COUNTERS_4_VAL_ADDR A:0x60503590
y.create.l HWIO_PCNOC_EPRB1_SPROF_COUNTERS_5_PORTSEL_ADDR A:0x60503598
y.create.l HWIO_PCNOC_EPRB1_SPROF_COUNTERS_5_SRC_ADDR A:0x6050359c
y.create.l HWIO_PCNOC_EPRB1_SPROF_COUNTERS_5_ALARMMODE_ADDR A:0x605035a0
y.create.l HWIO_PCNOC_EPRB1_SPROF_COUNTERS_5_VAL_ADDR A:0x605035a4
y.create.l HWIO_PCNOC_EPRB1_SPROF_COUNTERS_6_PORTSEL_ADDR A:0x605035ac
y.create.l HWIO_PCNOC_EPRB1_SPROF_COUNTERS_6_SRC_ADDR A:0x605035b0
y.create.l HWIO_PCNOC_EPRB1_SPROF_COUNTERS_6_ALARMMODE_ADDR A:0x605035b4
y.create.l HWIO_PCNOC_EPRB1_SPROF_COUNTERS_6_VAL_ADDR A:0x605035b8
y.create.l HWIO_PCNOC_EPRB1_SPROF_COUNTERS_7_PORTSEL_ADDR A:0x605035c0
y.create.l HWIO_PCNOC_EPRB1_SPROF_COUNTERS_7_SRC_ADDR A:0x605035c4
y.create.l HWIO_PCNOC_EPRB1_SPROF_COUNTERS_7_ALARMMODE_ADDR A:0x605035c8
y.create.l HWIO_PCNOC_EPRB1_SPROF_COUNTERS_7_VAL_ADDR A:0x605035cc
y.create.l HWIO_PCNOC_EPRB1_SPROF_COUNTERS_8_PORTSEL_ADDR A:0x605035d4
y.create.l HWIO_PCNOC_EPRB1_SPROF_COUNTERS_8_SRC_ADDR A:0x605035d8
y.create.l HWIO_PCNOC_EPRB1_SPROF_COUNTERS_8_ALARMMODE_ADDR A:0x605035dc
y.create.l HWIO_PCNOC_EPRB1_SPROF_COUNTERS_8_VAL_ADDR A:0x605035e0
y.create.l HWIO_PCNOC_EPRB1_SPROF_COUNTERS_9_PORTSEL_ADDR A:0x605035e8
y.create.l HWIO_PCNOC_EPRB1_SPROF_COUNTERS_9_SRC_ADDR A:0x605035ec
y.create.l HWIO_PCNOC_EPRB1_SPROF_COUNTERS_9_ALARMMODE_ADDR A:0x605035f0
y.create.l HWIO_PCNOC_EPRB1_SPROF_COUNTERS_9_VAL_ADDR A:0x605035f4
y.create.l HWIO_PCNOC_TPRB0_SPROF_ID_COREID_ADDR A:0x60504000
y.create.l HWIO_PCNOC_TPRB0_SPROF_ID_REVISIONID_ADDR A:0x60504004
y.create.l HWIO_PCNOC_TPRB0_SPROF_MAINCTL_ADDR A:0x60504008
y.create.l HWIO_PCNOC_TPRB0_SPROF_CFGCTL_ADDR A:0x6050400c
y.create.l HWIO_PCNOC_TPRB0_SPROF_STATPERIOD_ADDR A:0x60504024
y.create.l HWIO_PCNOC_TPRB0_SPROF_STATGO_ADDR A:0x60504028
y.create.l HWIO_PCNOC_TPRB0_SPROF_STATALARMMIN_ADDR A:0x6050402c
y.create.l HWIO_PCNOC_TPRB0_SPROF_STATALARMMAX_ADDR A:0x60504030
y.create.l HWIO_PCNOC_TPRB0_SPROF_STATALARMSTATUS_ADDR A:0x60504034
y.create.l HWIO_PCNOC_TPRB0_SPROF_STATALARMCLR_ADDR A:0x60504038
y.create.l HWIO_PCNOC_TPRB0_SPROF_STATALARMEN_ADDR A:0x6050403c
y.create.l HWIO_PCNOC_TPRB0_SPROF_COUNTERS_0_SRC_ADDR A:0x60504138
y.create.l HWIO_PCNOC_TPRB0_SPROF_COUNTERS_0_ALARMMODE_ADDR A:0x6050413c
y.create.l HWIO_PCNOC_TPRB0_SPROF_COUNTERS_0_VAL_ADDR A:0x60504140
y.create.l HWIO_PCNOC_TPRB0_SPROF_COUNTERS_1_SRC_ADDR A:0x6050414c
y.create.l HWIO_PCNOC_TPRB0_SPROF_COUNTERS_1_ALARMMODE_ADDR A:0x60504150
y.create.l HWIO_PCNOC_TPRB0_SPROF_COUNTERS_1_VAL_ADDR A:0x60504154
y.create.l HWIO_PCNOC_TPRB0_SPROF_COUNTERS_2_SRC_ADDR A:0x60504160
y.create.l HWIO_PCNOC_TPRB0_SPROF_COUNTERS_2_ALARMMODE_ADDR A:0x60504164
y.create.l HWIO_PCNOC_TPRB0_SPROF_COUNTERS_2_VAL_ADDR A:0x60504168
y.create.l HWIO_PCNOC_TPRB0_SPROF_COUNTERS_3_SRC_ADDR A:0x60504174
y.create.l HWIO_PCNOC_TPRB0_SPROF_COUNTERS_3_ALARMMODE_ADDR A:0x60504178
y.create.l HWIO_PCNOC_TPRB0_SPROF_COUNTERS_3_VAL_ADDR A:0x6050417c
y.create.l HWIO_PCNOC_TPRB0_SPROF_COUNTERS_4_SRC_ADDR A:0x60504188
y.create.l HWIO_PCNOC_TPRB0_SPROF_COUNTERS_4_ALARMMODE_ADDR A:0x6050418c
y.create.l HWIO_PCNOC_TPRB0_SPROF_COUNTERS_4_VAL_ADDR A:0x60504190
y.create.l HWIO_PCNOC_TPRB0_SPROF_COUNTERS_5_SRC_ADDR A:0x6050419c
y.create.l HWIO_PCNOC_TPRB0_SPROF_COUNTERS_5_ALARMMODE_ADDR A:0x605041a0
y.create.l HWIO_PCNOC_TPRB0_SPROF_COUNTERS_5_VAL_ADDR A:0x605041a4
y.create.l HWIO_PCNOC_TPRB0_SPROF_COUNTERS_6_SRC_ADDR A:0x605041b0
y.create.l HWIO_PCNOC_TPRB0_SPROF_COUNTERS_6_ALARMMODE_ADDR A:0x605041b4
y.create.l HWIO_PCNOC_TPRB0_SPROF_COUNTERS_6_VAL_ADDR A:0x605041b8
y.create.l HWIO_PCNOC_TPRB0_SPROF_COUNTERS_7_SRC_ADDR A:0x605041c4
y.create.l HWIO_PCNOC_TPRB0_SPROF_COUNTERS_7_ALARMMODE_ADDR A:0x605041c8
y.create.l HWIO_PCNOC_TPRB0_SPROF_COUNTERS_7_VAL_ADDR A:0x605041cc
y.create.l HWIO_PCNOC_TPRB0_SPROF_COUNTERS_8_SRC_ADDR A:0x605041d8
y.create.l HWIO_PCNOC_TPRB0_SPROF_COUNTERS_8_ALARMMODE_ADDR A:0x605041dc
y.create.l HWIO_PCNOC_TPRB0_SPROF_COUNTERS_8_VAL_ADDR A:0x605041e0
y.create.l HWIO_PCNOC_TPRB0_SPROF_COUNTERS_9_SRC_ADDR A:0x605041ec
y.create.l HWIO_PCNOC_TPRB0_SPROF_COUNTERS_9_ALARMMODE_ADDR A:0x605041f0
y.create.l HWIO_PCNOC_TPRB0_SPROF_COUNTERS_9_VAL_ADDR A:0x605041f4
y.create.l HWIO_PCNOC_TPRB0_SPROF_COUNTERS_10_SRC_ADDR A:0x60504200
y.create.l HWIO_PCNOC_TPRB0_SPROF_COUNTERS_10_ALARMMODE_ADDR A:0x60504204
y.create.l HWIO_PCNOC_TPRB0_SPROF_COUNTERS_10_VAL_ADDR A:0x60504208
y.create.l HWIO_PCNOC_TPRB0_SPROF_COUNTERS_11_SRC_ADDR A:0x60504214
y.create.l HWIO_PCNOC_TPRB0_SPROF_COUNTERS_11_ALARMMODE_ADDR A:0x60504218
y.create.l HWIO_PCNOC_TPRB0_SPROF_COUNTERS_11_VAL_ADDR A:0x6050421c
y.create.l HWIO_PCNOC_TPRB0_SPROF_COUNTERS_12_SRC_ADDR A:0x60504228
y.create.l HWIO_PCNOC_TPRB0_SPROF_COUNTERS_12_ALARMMODE_ADDR A:0x6050422c
y.create.l HWIO_PCNOC_TPRB0_SPROF_COUNTERS_12_VAL_ADDR A:0x60504230
y.create.l HWIO_PCNOC_TPRB0_SPROF_COUNTERS_13_SRC_ADDR A:0x6050423c
y.create.l HWIO_PCNOC_TPRB0_SPROF_COUNTERS_13_ALARMMODE_ADDR A:0x60504240
y.create.l HWIO_PCNOC_TPRB0_SPROF_COUNTERS_13_VAL_ADDR A:0x60504244
y.create.l HWIO_PCNOC_TPRB0_SPROF_COUNTERS_14_SRC_ADDR A:0x60504250
y.create.l HWIO_PCNOC_TPRB0_SPROF_COUNTERS_14_ALARMMODE_ADDR A:0x60504254
y.create.l HWIO_PCNOC_TPRB0_SPROF_COUNTERS_14_VAL_ADDR A:0x60504258
y.create.l HWIO_PCNOC_TPRB0_SPROF_COUNTERS_15_SRC_ADDR A:0x60504264
y.create.l HWIO_PCNOC_TPRB0_SPROF_COUNTERS_15_ALARMMODE_ADDR A:0x60504268
y.create.l HWIO_PCNOC_TPRB0_SPROF_COUNTERS_15_VAL_ADDR A:0x6050426c
y.create.l HWIO_PCNOC_TPRB1_SPROF_ID_COREID_ADDR A:0x60504400
y.create.l HWIO_PCNOC_TPRB1_SPROF_ID_REVISIONID_ADDR A:0x60504404
y.create.l HWIO_PCNOC_TPRB1_SPROF_MAINCTL_ADDR A:0x60504408
y.create.l HWIO_PCNOC_TPRB1_SPROF_CFGCTL_ADDR A:0x6050440c
y.create.l HWIO_PCNOC_TPRB1_SPROF_STATPERIOD_ADDR A:0x60504424
y.create.l HWIO_PCNOC_TPRB1_SPROF_STATGO_ADDR A:0x60504428
y.create.l HWIO_PCNOC_TPRB1_SPROF_STATALARMMIN_ADDR A:0x6050442c
y.create.l HWIO_PCNOC_TPRB1_SPROF_STATALARMMAX_ADDR A:0x60504430
y.create.l HWIO_PCNOC_TPRB1_SPROF_STATALARMSTATUS_ADDR A:0x60504434
y.create.l HWIO_PCNOC_TPRB1_SPROF_STATALARMCLR_ADDR A:0x60504438
y.create.l HWIO_PCNOC_TPRB1_SPROF_STATALARMEN_ADDR A:0x6050443c
y.create.l HWIO_PCNOC_TPRB1_SPROF_COUNTERS_0_SRC_ADDR A:0x60504538
y.create.l HWIO_PCNOC_TPRB1_SPROF_COUNTERS_0_ALARMMODE_ADDR A:0x6050453c
y.create.l HWIO_PCNOC_TPRB1_SPROF_COUNTERS_0_VAL_ADDR A:0x60504540
y.create.l HWIO_PCNOC_TPRB1_SPROF_COUNTERS_1_SRC_ADDR A:0x6050454c
y.create.l HWIO_PCNOC_TPRB1_SPROF_COUNTERS_1_ALARMMODE_ADDR A:0x60504550
y.create.l HWIO_PCNOC_TPRB1_SPROF_COUNTERS_1_VAL_ADDR A:0x60504554
y.create.l HWIO_PCNOC_TPRB1_SPROF_COUNTERS_2_SRC_ADDR A:0x60504560
y.create.l HWIO_PCNOC_TPRB1_SPROF_COUNTERS_2_ALARMMODE_ADDR A:0x60504564
y.create.l HWIO_PCNOC_TPRB1_SPROF_COUNTERS_2_VAL_ADDR A:0x60504568
y.create.l HWIO_PCNOC_TPRB1_SPROF_COUNTERS_3_SRC_ADDR A:0x60504574
y.create.l HWIO_PCNOC_TPRB1_SPROF_COUNTERS_3_ALARMMODE_ADDR A:0x60504578
y.create.l HWIO_PCNOC_TPRB1_SPROF_COUNTERS_3_VAL_ADDR A:0x6050457c
y.create.l HWIO_PCNOC_TPRB1_SPROF_COUNTERS_4_SRC_ADDR A:0x60504588
y.create.l HWIO_PCNOC_TPRB1_SPROF_COUNTERS_4_ALARMMODE_ADDR A:0x6050458c
y.create.l HWIO_PCNOC_TPRB1_SPROF_COUNTERS_4_VAL_ADDR A:0x60504590
y.create.l HWIO_PCNOC_TPRB1_SPROF_COUNTERS_5_SRC_ADDR A:0x6050459c
y.create.l HWIO_PCNOC_TPRB1_SPROF_COUNTERS_5_ALARMMODE_ADDR A:0x605045a0
y.create.l HWIO_PCNOC_TPRB1_SPROF_COUNTERS_5_VAL_ADDR A:0x605045a4
y.create.l HWIO_PCNOC_TPRB1_SPROF_COUNTERS_6_SRC_ADDR A:0x605045b0
y.create.l HWIO_PCNOC_TPRB1_SPROF_COUNTERS_6_ALARMMODE_ADDR A:0x605045b4
y.create.l HWIO_PCNOC_TPRB1_SPROF_COUNTERS_6_VAL_ADDR A:0x605045b8
y.create.l HWIO_PCNOC_TPRB1_SPROF_COUNTERS_7_SRC_ADDR A:0x605045c4
y.create.l HWIO_PCNOC_TPRB1_SPROF_COUNTERS_7_ALARMMODE_ADDR A:0x605045c8
y.create.l HWIO_PCNOC_TPRB1_SPROF_COUNTERS_7_VAL_ADDR A:0x605045cc
y.create.l HWIO_PCNOC_TPRB1_SPROF_COUNTERS_8_SRC_ADDR A:0x605045d8
y.create.l HWIO_PCNOC_TPRB1_SPROF_COUNTERS_8_ALARMMODE_ADDR A:0x605045dc
y.create.l HWIO_PCNOC_TPRB1_SPROF_COUNTERS_8_VAL_ADDR A:0x605045e0
y.create.l HWIO_PCNOC_TPRB1_SPROF_COUNTERS_9_SRC_ADDR A:0x605045ec
y.create.l HWIO_PCNOC_TPRB1_SPROF_COUNTERS_9_ALARMMODE_ADDR A:0x605045f0
y.create.l HWIO_PCNOC_TPRB1_SPROF_COUNTERS_9_VAL_ADDR A:0x605045f4
y.create.l HWIO_PCNOC_TPRB1_SPROF_COUNTERS_10_SRC_ADDR A:0x60504600
y.create.l HWIO_PCNOC_TPRB1_SPROF_COUNTERS_10_ALARMMODE_ADDR A:0x60504604
y.create.l HWIO_PCNOC_TPRB1_SPROF_COUNTERS_10_VAL_ADDR A:0x60504608
y.create.l HWIO_PCNOC_TPRB1_SPROF_COUNTERS_11_SRC_ADDR A:0x60504614
y.create.l HWIO_PCNOC_TPRB1_SPROF_COUNTERS_11_ALARMMODE_ADDR A:0x60504618
y.create.l HWIO_PCNOC_TPRB1_SPROF_COUNTERS_11_VAL_ADDR A:0x6050461c
y.create.l HWIO_PCNOC_TPRB1_SPROF_COUNTERS_12_SRC_ADDR A:0x60504628
y.create.l HWIO_PCNOC_TPRB1_SPROF_COUNTERS_12_ALARMMODE_ADDR A:0x6050462c
y.create.l HWIO_PCNOC_TPRB1_SPROF_COUNTERS_12_VAL_ADDR A:0x60504630
y.create.l HWIO_PCNOC_TPRB1_SPROF_COUNTERS_13_SRC_ADDR A:0x6050463c
y.create.l HWIO_PCNOC_TPRB1_SPROF_COUNTERS_13_ALARMMODE_ADDR A:0x60504640
y.create.l HWIO_PCNOC_TPRB1_SPROF_COUNTERS_13_VAL_ADDR A:0x60504644
y.create.l HWIO_PCNOC_TPRB1_SPROF_COUNTERS_14_SRC_ADDR A:0x60504650
y.create.l HWIO_PCNOC_TPRB1_SPROF_COUNTERS_14_ALARMMODE_ADDR A:0x60504654
y.create.l HWIO_PCNOC_TPRB1_SPROF_COUNTERS_14_VAL_ADDR A:0x60504658
y.create.l HWIO_PCNOC_TPRB1_SPROF_COUNTERS_15_SRC_ADDR A:0x60504664
y.create.l HWIO_PCNOC_TPRB1_SPROF_COUNTERS_15_ALARMMODE_ADDR A:0x60504668
y.create.l HWIO_PCNOC_TPRB1_SPROF_COUNTERS_15_VAL_ADDR A:0x6050466c
y.create.l HWIO_PCNOC_CRYPTO0_QOS_ID_COREID_ADDR A:0x60507000
y.create.l HWIO_PCNOC_CRYPTO0_QOS_ID_REVISIONID_ADDR A:0x60507004
y.create.l HWIO_PCNOC_CRYPTO0_QOS_PRIORITY_ADDR A:0x60507008
y.create.l HWIO_PCNOC_CRYPTO0_QOS_MODE_ADDR A:0x6050700c
y.create.l HWIO_PCNOC_CRYPTO0_QOS_EXTCONTROL_ADDR A:0x60507018
y.create.l HWIO_PCNOC_QHM1_QOS_ID_COREID_ADDR A:0x6050c000
y.create.l HWIO_PCNOC_QHM1_QOS_ID_REVISIONID_ADDR A:0x6050c004
y.create.l HWIO_PCNOC_QHM1_QOS_PRIORITY_ADDR A:0x6050c008
y.create.l HWIO_PCNOC_QHM1_QOS_MODE_ADDR A:0x6050c00c
y.create.l HWIO_PCNOC_QHM1_QOS_EXTCONTROL_ADDR A:0x6050c018
y.create.l HWIO_PCNOC_QHM2_QOS_ID_COREID_ADDR A:0x6050d000
y.create.l HWIO_PCNOC_QHM2_QOS_ID_REVISIONID_ADDR A:0x6050d004
y.create.l HWIO_PCNOC_QHM2_QOS_PRIORITY_ADDR A:0x6050d008
y.create.l HWIO_PCNOC_QHM2_QOS_MODE_ADDR A:0x6050d00c
y.create.l HWIO_PCNOC_QHM2_QOS_EXTCONTROL_ADDR A:0x6050d018
y.create.l HWIO_PCNOC_SDC1_QOS_ID_COREID_ADDR A:0x6050e000
y.create.l HWIO_PCNOC_SDC1_QOS_ID_REVISIONID_ADDR A:0x6050e004
y.create.l HWIO_PCNOC_SDC1_QOS_PRIORITY_ADDR A:0x6050e008
y.create.l HWIO_PCNOC_SDC1_QOS_MODE_ADDR A:0x6050e00c
y.create.l HWIO_PCNOC_SDC1_QOS_EXTCONTROL_ADDR A:0x6050e018
y.create.l HWIO_PCNOC_SDC2_QOS_ID_COREID_ADDR A:0x6050f000
y.create.l HWIO_PCNOC_SDC2_QOS_ID_REVISIONID_ADDR A:0x6050f004
y.create.l HWIO_PCNOC_SDC2_QOS_PRIORITY_ADDR A:0x6050f008
y.create.l HWIO_PCNOC_SDC2_QOS_MODE_ADDR A:0x6050f00c
y.create.l HWIO_PCNOC_SDC2_QOS_EXTCONTROL_ADDR A:0x6050f018
y.create.l HWIO_PCNOC_QXM_NOC_QOS_ID_COREID_ADDR A:0x60510000
y.create.l HWIO_PCNOC_QXM_NOC_QOS_ID_REVISIONID_ADDR A:0x60510004
y.create.l HWIO_PCNOC_QXM_NOC_QOS_PRIORITY_ADDR A:0x60510008
y.create.l HWIO_PCNOC_QXM_NOC_QOS_MODE_ADDR A:0x6051000c
y.create.l HWIO_PCNOC_QXM_NOC_QOS_EXTCONTROL_ADDR A:0x60510018
y.create.l HWIO_PCNOC_SGMI_QOS_ID_COREID_ADDR A:0x60511000
y.create.l HWIO_PCNOC_SGMI_QOS_ID_REVISIONID_ADDR A:0x60511004
y.create.l HWIO_PCNOC_SGMI_QOS_PRIORITY_ADDR A:0x60511008
y.create.l HWIO_PCNOC_SGMI_QOS_MODE_ADDR A:0x6051100c
y.create.l HWIO_PCNOC_SGMI_QOS_EXTCONTROL_ADDR A:0x60511018
y.create.l HWIO_PCNOC_HSIC_QOS_ID_COREID_ADDR A:0x60512000
y.create.l HWIO_PCNOC_HSIC_QOS_ID_REVISIONID_ADDR A:0x60512004
y.create.l HWIO_PCNOC_HSIC_QOS_PRIORITY_ADDR A:0x60512008
y.create.l HWIO_PCNOC_HSIC_QOS_MODE_ADDR A:0x6051200c
y.create.l HWIO_PCNOC_HSIC_QOS_EXTCONTROL_ADDR A:0x60512018
y.create.l HWIO_PCNOC_USB_HS1_QOS_ID_COREID_ADDR A:0x60513000
y.create.l HWIO_PCNOC_USB_HS1_QOS_ID_REVISIONID_ADDR A:0x60513004
y.create.l HWIO_PCNOC_USB_HS1_QOS_PRIORITY_ADDR A:0x60513008
y.create.l HWIO_PCNOC_USB_HS1_QOS_MODE_ADDR A:0x6051300c
y.create.l HWIO_PCNOC_USB_HS1_QOS_EXTCONTROL_ADDR A:0x60513018
y.create.l HWIO_PCNOC_QDSS_BAM_QOS_ID_COREID_ADDR A:0x60514000
y.create.l HWIO_PCNOC_QDSS_BAM_QOS_ID_REVISIONID_ADDR A:0x60514004
y.create.l HWIO_PCNOC_QDSS_BAM_QOS_PRIORITY_ADDR A:0x60514008
y.create.l HWIO_PCNOC_QDSS_BAM_QOS_MODE_ADDR A:0x6051400c
y.create.l HWIO_PCNOC_QDSS_BAM_QOS_EXTCONTROL_ADDR A:0x60514018
y.create.l HWIO_PCNOC_QDSS_ETR_QOS_ID_COREID_ADDR A:0x60515000
y.create.l HWIO_PCNOC_QDSS_ETR_QOS_ID_REVISIONID_ADDR A:0x60515004
y.create.l HWIO_PCNOC_QDSS_ETR_QOS_PRIORITY_ADDR A:0x60515008
y.create.l HWIO_PCNOC_QDSS_ETR_QOS_MODE_ADDR A:0x6051500c
y.create.l HWIO_PCNOC_QDSS_ETR_QOS_EXTCONTROL_ADDR A:0x60515018
y.create.l HWIO_PDM_TCXO_PDM0_TOP_CTL_ADDR A:0x60068000
y.create.l HWIO_PDM_PDM0_CTL_ADDR A:0x60068004
y.create.l HWIO_PDM_WEB_TCXO4_TEST_ADDR A:0x60068008
y.create.l HWIO_PDM_TCXO_PDM1_TOP_CTL_ADDR A:0x60069000
y.create.l HWIO_PDM_PDM1_CTL_ADDR A:0x60069004
y.create.l HWIO_PDM_TCXO_PDM2_TOP_CTL_ADDR A:0x6006a000
y.create.l HWIO_PDM_PDM2_CTL_ADDR A:0x6006a004
y.create.l HWIO_PDM_GP_MN_CLK_MDIV_ADDR A:0x6006b000
y.create.l HWIO_PDM_GP_MN_CLK_NDIV_ADDR A:0x6006b004
y.create.l HWIO_PDM_GP_MN_CLK_DUTY_ADDR A:0x6006b008
y.create.l HWIO_SPMI_GENI_CLK_CTRL_ADDR A:0x6200a000
y.create.l HWIO_SPMI_GENI_HW_VERSION_ADDR A:0x6200a004
y.create.l HWIO_SPMI_GENI_FW_REVISION_ADDR A:0x6200a008
y.create.l HWIO_SPMI_GENI_S_FW_REVISION_ADDR A:0x6200a00c
y.create.l HWIO_SPMI_GENI_FORCE_DEFAULT_REG_ADDR A:0x6200a010
y.create.l HWIO_SPMI_GENI_OUTPUT_CTRL_ADDR A:0x6200a014
y.create.l HWIO_SPMI_GENI_CGC_CTRL_ADDR A:0x6200a018
y.create.l HWIO_SPMI_GENI_CHAR_CFG_ADDR A:0x6200a01c
y.create.l HWIO_SPMI_GENI_CHAR_DATA_0_ADDR A:0x6200a020
y.create.l HWIO_SPMI_GENI_CHAR_DATA_1_ADDR A:0x6200a024
y.create.l HWIO_SPMI_GENI_CTRL_ADDR A:0x6200a028
y.create.l HWIO_SPMI_GENI_STATUS_ADDR A:0x6200a02c
y.create.l HWIO_SPMI_GENI_TEST_BUS_CTRL_ADDR A:0x6200a030
y.create.l HWIO_SPMI_GENI_SER_CLK_CFG_ADDR A:0x6200a034
y.create.l HWIO_SPMI_GENI_TX_WATERMARK_REG_ADDR A:0x6200a038
y.create.l HWIO_SPMI_GENI_RX_WATERMARK_REG_ADDR A:0x6200a03c
y.create.l HWIO_SPMI_GENI_STOP_REG_ADDR A:0x6200a040
y.create.l HWIO_SPMI_GENI_SW_COMP_REG_ADDR A:0x6200a044
y.create.l HWIO_SPMI_GENI_PROG_ROM_CTRL_REG_ADDR A:0x6200a048
y.create.l HWIO_SPMI_GENI_CFG_REG0_ADDR A:0x6200a100
y.create.l HWIO_SPMI_GENI_CFG_REG1_ADDR A:0x6200a104
y.create.l HWIO_SPMI_GENI_CFG_REG2_ADDR A:0x6200a108
y.create.l HWIO_SPMI_GENI_CFG_REG3_ADDR A:0x6200a10c
y.create.l HWIO_SPMI_GENI_CFG_REG4_ADDR A:0x6200a110
y.create.l HWIO_SPMI_GENI_CFG_REG5_ADDR A:0x6200a114
y.create.l HWIO_SPMI_GENI_CFG_REG6_ADDR A:0x6200a118
y.create.l HWIO_SPMI_GENI_CFG_REG7_ADDR A:0x6200a11c
y.create.l HWIO_SPMI_GENI_CFG_REG8_ADDR A:0x6200a120
y.create.l HWIO_SPMI_GENI_CFG_REG9_ADDR A:0x6200a124
y.create.l HWIO_SPMI_GENI_CFG_REG10_ADDR A:0x6200a128
y.create.l HWIO_SPMI_GENI_CFG_REG11_ADDR A:0x6200a12c
y.create.l HWIO_SPMI_GENI_CFG_REG12_ADDR A:0x6200a130
y.create.l HWIO_SPMI_GENI_CFG_REG13_ADDR A:0x6200a134
y.create.l HWIO_SPMI_GENI_CFG_REG14_ADDR A:0x6200a138
y.create.l HWIO_SPMI_GENI_CFG_REG15_ADDR A:0x6200a13c
y.create.l HWIO_SPMI_GENI_CFG_REG16_ADDR A:0x6200a140
y.create.l HWIO_SPMI_GENI_CFG_REG17_ADDR A:0x6200a144
y.create.l HWIO_SPMI_GENI_CFG_REG18_ADDR A:0x6200a148
y.create.l HWIO_SPMI_GENI_CFG_REG19_ADDR A:0x6200a14c
y.create.l HWIO_SPMI_GENI_CFG_REG20_ADDR A:0x6200a150
y.create.l HWIO_SPMI_GENI_CFG_REG21_ADDR A:0x6200a154
y.create.l HWIO_SPMI_GENI_CFG_REG22_ADDR A:0x6200a158
y.create.l HWIO_SPMI_GENI_CFG_REG23_ADDR A:0x6200a15c
y.create.l HWIO_SPMI_GENI_CFG_REG24_ADDR A:0x6200a160
y.create.l HWIO_SPMI_GENI_CFG_REG25_ADDR A:0x6200a164
y.create.l HWIO_SPMI_GENI_CFG_REG26_ADDR A:0x6200a168
y.create.l HWIO_SPMI_GENI_CFG_REG27_ADDR A:0x6200a16c
y.create.l HWIO_SPMI_GENI_CFG_REG28_ADDR A:0x6200a170
y.create.l HWIO_SPMI_GENI_CFG_REG29_ADDR A:0x6200a174
y.create.l HWIO_SPMI_GENI_CFG_REG30_ADDR A:0x6200a178
y.create.l HWIO_SPMI_GENI_CFG_RAM0_ADDR A:0x6200a200
y.create.l HWIO_SPMI_GENI_CFG_RAM1_ADDR A:0x6200a204
y.create.l HWIO_SPMI_GENI_CFG_RAM2_ADDR A:0x6200a208
y.create.l HWIO_SPMI_GENI_CFG_RAM3_ADDR A:0x6200a20c
y.create.l HWIO_SPMI_GENI_CFG_RAM4_ADDR A:0x6200a210
y.create.l HWIO_SPMI_GENI_CFG_RAM5_ADDR A:0x6200a214
y.create.l HWIO_SPMI_GENI_CFG_RAM6_ADDR A:0x6200a218
y.create.l HWIO_SPMI_GENI_CFG_RAM7_ADDR A:0x6200a21c
y.create.l HWIO_SPMI_GENI_CFG_RAM8_ADDR A:0x6200a220
y.create.l HWIO_SPMI_GENI_CFG_RAM9_ADDR A:0x6200a224
y.create.l HWIO_SPMI_PERIPH0_2OWNER_TABLE_REG_ADDR A:0x6200a700
y.create.l HWIO_SPMI_PERIPH1_2OWNER_TABLE_REG_ADDR A:0x6200a704
y.create.l HWIO_SPMI_PERIPH2_2OWNER_TABLE_REG_ADDR A:0x6200a708
y.create.l HWIO_SPMI_PERIPH3_2OWNER_TABLE_REG_ADDR A:0x6200a70c
y.create.l HWIO_SPMI_PERIPH4_2OWNER_TABLE_REG_ADDR A:0x6200a710
y.create.l HWIO_SPMI_PERIPH5_2OWNER_TABLE_REG_ADDR A:0x6200a714
y.create.l HWIO_SPMI_PERIPH6_2OWNER_TABLE_REG_ADDR A:0x6200a718
y.create.l HWIO_SPMI_PERIPH7_2OWNER_TABLE_REG_ADDR A:0x6200a71c
y.create.l HWIO_SPMI_PERIPH8_2OWNER_TABLE_REG_ADDR A:0x6200a720
y.create.l HWIO_SPMI_PERIPH9_2OWNER_TABLE_REG_ADDR A:0x6200a724
y.create.l HWIO_SPMI_MAPPING_TABLE_REG0_ADDR A:0x6200ab00
y.create.l HWIO_SPMI_MAPPING_TABLE_REG1_ADDR A:0x6200ab04
y.create.l HWIO_SPMI_MAPPING_TABLE_REG2_ADDR A:0x6200ab08
y.create.l HWIO_SPMI_MAPPING_TABLE_REG3_ADDR A:0x6200ab0c
y.create.l HWIO_SPMI_MAPPING_TABLE_REG4_ADDR A:0x6200ab10
y.create.l HWIO_SPMI_MAPPING_TABLE_REG5_ADDR A:0x6200ab14
y.create.l HWIO_SPMI_MAPPING_TABLE_REG6_ADDR A:0x6200ab18
y.create.l HWIO_SPMI_MAPPING_TABLE_REG7_ADDR A:0x6200ab1c
y.create.l HWIO_SPMI_MAPPING_TABLE_REG8_ADDR A:0x6200ab20
y.create.l HWIO_SPMI_MAPPING_TABLE_REG9_ADDR A:0x6200ab24
y.create.l HWIO_SPMI_MID_REG_ADDR A:0x6200af00
y.create.l HWIO_SPMI_CFG_REG_ADDR A:0x6200af04
y.create.l HWIO_SPMI_SEC_DISABLE_REG_ADDR A:0x6200af08
y.create.l HWIO_SPMI_HW_VERSION_ADDR A:0x6200af0c
y.create.l HWIO_SPMI_CGC_CTRL_ADDR A:0x6200af10
y.create.l HWIO_SPMI_MWB_ENABLE_REG_ADDR A:0x6200af14
y.create.l HWIO_SPMI_CHAR_CFG_ADDR A:0x6200af40
y.create.l HWIO_SPMI_CHAR_DATA_0_ADDR A:0x6200af44
y.create.l HWIO_SPMI_CHAR_DATA_1_ADDR A:0x6200af48
y.create.l HWIO_SPMI_CMPR_EN_REG_ADDR A:0x6200af54
y.create.l HWIO_SPMI_PROTOCOL_IRQ_STATUS_ADDR A:0x6200b000
y.create.l HWIO_SPMI_PROTOCOL_IRQ_ENABLE_ADDR A:0x6200b004
y.create.l HWIO_SPMI_PROTOCOL_IRQ_CLEAR_ADDR A:0x6200b008
y.create.l HWIO_SPMI_PROTOCOL_IRQ_EN_SET_ADDR A:0x6200b00c
y.create.l HWIO_SPMI_PROTOCOL_IRQ_EN_CLEAR_ADDR A:0x6200b010
y.create.l HWIO_SPMI_TEST_BUS_CTRL_ADDR A:0x6200c000
y.create.l HWIO_SPMI_HW_SW_EVENTS_CTRL_ADDR A:0x6200c004
y.create.l HWIO_SPMI_HW_SW_EVENTS_BITWISE_REG0_ADDR A:0x6200c008
y.create.l HWIO_SPMI_HW_SW_EVENTS_BITWISE_REG1_ADDR A:0x6200c00c
y.create.l HWIO_SPMI_HW_SW_EVENTS_BITWISE_REG2_ADDR A:0x6200c010
y.create.l HWIO_SPMI_HW_SW_EVENTS_BITWISE_REG3_ADDR A:0x6200c014
y.create.l HWIO_SPMI_HW_SW_EVENTS_BITWISE_REG4_ADDR A:0x6200c018
y.create.l HWIO_SPMI_HW_SW_EVENTS_BITWISE_REG5_ADDR A:0x6200c01c
y.create.l HWIO_SPMI_HW_SW_EVENTS_BITWISE_REG6_ADDR A:0x6200c020
y.create.l HWIO_SPMI_HW_SW_EVENTS_BITWISE_REG7_ADDR A:0x6200c024
y.create.l HWIO_SPMI_PIC_OWNER0_ACC_STATUS0_ADDR A:0x63900000
y.create.l HWIO_SPMI_PIC_OWNER0_ACC_STATUS1_ADDR A:0x63900004
y.create.l HWIO_SPMI_PIC_OWNER0_ACC_STATUS2_ADDR A:0x63900008
y.create.l HWIO_SPMI_PIC_OWNER0_ACC_STATUS3_ADDR A:0x6390000c
y.create.l HWIO_SPMI_PIC_OWNER1_ACC_STATUS0_ADDR A:0x63901000
y.create.l HWIO_SPMI_PIC_OWNER1_ACC_STATUS1_ADDR A:0x63901004
y.create.l HWIO_SPMI_PIC_OWNER1_ACC_STATUS2_ADDR A:0x63901008
y.create.l HWIO_SPMI_PIC_OWNER1_ACC_STATUS3_ADDR A:0x6390100c
y.create.l HWIO_SPMI_PIC_OWNER2_ACC_STATUS0_ADDR A:0x63902000
y.create.l HWIO_SPMI_PIC_OWNER2_ACC_STATUS1_ADDR A:0x63902004
y.create.l HWIO_SPMI_PIC_OWNER2_ACC_STATUS2_ADDR A:0x63902008
y.create.l HWIO_SPMI_PIC_OWNER2_ACC_STATUS3_ADDR A:0x6390200c
y.create.l HWIO_SPMI_PIC_OWNER3_ACC_STATUS0_ADDR A:0x63903000
y.create.l HWIO_SPMI_PIC_OWNER3_ACC_STATUS1_ADDR A:0x63903004
y.create.l HWIO_SPMI_PIC_OWNER3_ACC_STATUS2_ADDR A:0x63903008
y.create.l HWIO_SPMI_PIC_OWNER3_ACC_STATUS3_ADDR A:0x6390300c
y.create.l HWIO_SPMI_PIC_OWNER4_ACC_STATUS0_ADDR A:0x63904000
y.create.l HWIO_SPMI_PIC_OWNER4_ACC_STATUS1_ADDR A:0x63904004
y.create.l HWIO_SPMI_PIC_OWNER4_ACC_STATUS2_ADDR A:0x63904008
y.create.l HWIO_SPMI_PIC_OWNER4_ACC_STATUS3_ADDR A:0x6390400c
y.create.l HWIO_SPMI_PIC_OWNER5_ACC_STATUS0_ADDR A:0x63905000
y.create.l HWIO_SPMI_PIC_OWNER5_ACC_STATUS1_ADDR A:0x63905004
y.create.l HWIO_SPMI_PIC_OWNER5_ACC_STATUS2_ADDR A:0x63905008
y.create.l HWIO_SPMI_PIC_OWNER5_ACC_STATUS3_ADDR A:0x6390500c
y.create.l HWIO_SPMI_PIC_ACC_ENABLE0_ADDR A:0x63800000
y.create.l HWIO_SPMI_PIC_ACC_ENABLE1_ADDR A:0x63801000
y.create.l HWIO_SPMI_PIC_ACC_ENABLE2_ADDR A:0x63802000
y.create.l HWIO_SPMI_PIC_ACC_ENABLE3_ADDR A:0x63803000
y.create.l HWIO_SPMI_PIC_ACC_ENABLE4_ADDR A:0x63804000
y.create.l HWIO_SPMI_PIC_ACC_ENABLE5_ADDR A:0x63805000
y.create.l HWIO_SPMI_PIC_ACC_ENABLE6_ADDR A:0x63806000
y.create.l HWIO_SPMI_PIC_ACC_ENABLE7_ADDR A:0x63807000
y.create.l HWIO_SPMI_PIC_ACC_ENABLE8_ADDR A:0x63808000
y.create.l HWIO_SPMI_PIC_ACC_ENABLE9_ADDR A:0x63809000
y.create.l HWIO_SPMI_PIC_IRQ_STATUS0_ADDR A:0x63800004
y.create.l HWIO_SPMI_PIC_IRQ_STATUS1_ADDR A:0x63801004
y.create.l HWIO_SPMI_PIC_IRQ_STATUS2_ADDR A:0x63802004
y.create.l HWIO_SPMI_PIC_IRQ_STATUS3_ADDR A:0x63803004
y.create.l HWIO_SPMI_PIC_IRQ_STATUS4_ADDR A:0x63804004
y.create.l HWIO_SPMI_PIC_IRQ_STATUS5_ADDR A:0x63805004
y.create.l HWIO_SPMI_PIC_IRQ_STATUS6_ADDR A:0x63806004
y.create.l HWIO_SPMI_PIC_IRQ_STATUS7_ADDR A:0x63807004
y.create.l HWIO_SPMI_PIC_IRQ_STATUS8_ADDR A:0x63808004
y.create.l HWIO_SPMI_PIC_IRQ_STATUS9_ADDR A:0x63809004
y.create.l HWIO_SPMI_PIC_IRQ_CLEAR0_ADDR A:0x63800008
y.create.l HWIO_SPMI_PIC_IRQ_CLEAR1_ADDR A:0x63801008
y.create.l HWIO_SPMI_PIC_IRQ_CLEAR2_ADDR A:0x63802008
y.create.l HWIO_SPMI_PIC_IRQ_CLEAR3_ADDR A:0x63803008
y.create.l HWIO_SPMI_PIC_IRQ_CLEAR4_ADDR A:0x63804008
y.create.l HWIO_SPMI_PIC_IRQ_CLEAR5_ADDR A:0x63805008
y.create.l HWIO_SPMI_PIC_IRQ_CLEAR6_ADDR A:0x63806008
y.create.l HWIO_SPMI_PIC_IRQ_CLEAR7_ADDR A:0x63807008
y.create.l HWIO_SPMI_PIC_IRQ_CLEAR8_ADDR A:0x63808008
y.create.l HWIO_SPMI_PIC_IRQ_CLEAR9_ADDR A:0x63809008
y.create.l HWIO_PMIC_ARB_XPU_SCR_ADDR A:0x6200e000
y.create.l HWIO_PMIC_ARB_XPU_SWDR_ADDR A:0x6200e004
y.create.l HWIO_PMIC_ARB_XPU_PRTN_RACR_SSHADOW_ADDR A:0x6200e008
y.create.l HWIO_PMIC_ARB_XPU_PRTN_WACR_SSHADOW_ADDR A:0x6200e00c
y.create.l HWIO_PMIC_ARB_XPU_PRTN_START_SSHADOW0_ADDR A:0x6200e010
y.create.l HWIO_PMIC_ARB_XPU_PRTN_END_SSHADOW0_ADDR A:0x6200e018
y.create.l HWIO_PMIC_ARB_XPU_SEAR0_ADDR A:0x6200e040
y.create.l HWIO_PMIC_ARB_XPU_SESR_ADDR A:0x6200e048
y.create.l HWIO_PMIC_ARB_XPU_SESRRESTORE_ADDR A:0x6200e04c
y.create.l HWIO_PMIC_ARB_XPU_SESYNR0_ADDR A:0x6200e050
y.create.l HWIO_PMIC_ARB_XPU_SESYNR1_ADDR A:0x6200e054
y.create.l HWIO_PMIC_ARB_XPU_SESYNR2_ADDR A:0x6200e058
y.create.l HWIO_PMIC_ARB_XPU_MCR_ADDR A:0x6200e100
y.create.l HWIO_PMIC_ARB_XPU_MEAR0_ADDR A:0x6200e140
y.create.l HWIO_PMIC_ARB_XPU_MESR_ADDR A:0x6200e148
y.create.l HWIO_PMIC_ARB_XPU_MESRRESTORE_ADDR A:0x6200e14c
y.create.l HWIO_PMIC_ARB_XPU_MESYNR0_ADDR A:0x6200e150
y.create.l HWIO_PMIC_ARB_XPU_MESYNR1_ADDR A:0x6200e154
y.create.l HWIO_PMIC_ARB_XPU_MESYNR2_ADDR A:0x6200e158
y.create.l HWIO_PMIC_ARB_XPU_CR_ADDR A:0x6200e080
y.create.l HWIO_PMIC_ARB_XPU_PRTN_RACR_SHADOW_ADDR A:0x6200e088
y.create.l HWIO_PMIC_ARB_XPU_PRTN_WACR_SHADOW_ADDR A:0x6200e08c
y.create.l HWIO_PMIC_ARB_XPU_PRTN_START_SHADOW0_ADDR A:0x6200e090
y.create.l HWIO_PMIC_ARB_XPU_PRTN_END_SHADOW0_ADDR A:0x6200e098
y.create.l HWIO_PMIC_ARB_XPU_RPU_ACR0_ADDR A:0x6200e0a0
y.create.l HWIO_PMIC_ARB_XPU_EAR0_ADDR A:0x6200e0c0
y.create.l HWIO_PMIC_ARB_XPU_ESR_ADDR A:0x6200e0c8
y.create.l HWIO_PMIC_ARB_XPU_ESRRESTORE_ADDR A:0x6200e0cc
y.create.l HWIO_PMIC_ARB_XPU_ESYNR0_ADDR A:0x6200e0d0
y.create.l HWIO_PMIC_ARB_XPU_ESYNR1_ADDR A:0x6200e0d4
y.create.l HWIO_PMIC_ARB_XPU_ESYNR2_ADDR A:0x6200e0d8
y.create.l HWIO_PMIC_ARB_XPU_UMR_RACR_ADDR A:0x6200e0e0
y.create.l HWIO_PMIC_ARB_XPU_UMR_WACR_ADDR A:0x6200e0e4
y.create.l HWIO_PMIC_ARB_XPU_UMR_CNTL_ADDR A:0x6200e0f0
y.create.l HWIO_PMIC_ARB_XPU_IDR0_ADDR A:0x6200e074
y.create.l HWIO_PMIC_ARB_XPU_IDR1_ADDR A:0x6200e078
y.create.l HWIO_PMIC_ARB_XPU_REV_ADDR A:0x6200e07c
y.create.l HWIO_PMIC_ARB_XPU_PRT0_RACR0_ADDR A:0x6200e200
y.create.l HWIO_PMIC_ARB_XPU_PRT1_RACR0_ADDR A:0x6200e280
y.create.l HWIO_PMIC_ARB_XPU_PRT2_RACR0_ADDR A:0x6200e300
y.create.l HWIO_PMIC_ARB_XPU_PRT3_RACR0_ADDR A:0x6200e380
y.create.l HWIO_PMIC_ARB_XPU_PRT4_RACR0_ADDR A:0x6200e400
y.create.l HWIO_PMIC_ARB_XPU_PRT5_RACR0_ADDR A:0x6200e480
y.create.l HWIO_PMIC_ARB_XPU_PRT6_RACR0_ADDR A:0x6200e500
y.create.l HWIO_PMIC_ARB_XPU_PRT7_RACR0_ADDR A:0x6200e580
y.create.l HWIO_PMIC_ARB_XPU_PRT8_RACR0_ADDR A:0x6200e600
y.create.l HWIO_PMIC_ARB_XPU_PRT9_RACR0_ADDR A:0x6200e680
y.create.l HWIO_PMIC_ARB_XPU_PRT0_WACR0_ADDR A:0x6200e220
y.create.l HWIO_PMIC_ARB_XPU_PRT1_WACR0_ADDR A:0x6200e2a0
y.create.l HWIO_PMIC_ARB_XPU_PRT2_WACR0_ADDR A:0x6200e320
y.create.l HWIO_PMIC_ARB_XPU_PRT3_WACR0_ADDR A:0x6200e3a0
y.create.l HWIO_PMIC_ARB_XPU_PRT4_WACR0_ADDR A:0x6200e420
y.create.l HWIO_PMIC_ARB_XPU_PRT5_WACR0_ADDR A:0x6200e4a0
y.create.l HWIO_PMIC_ARB_XPU_PRT6_WACR0_ADDR A:0x6200e520
y.create.l HWIO_PMIC_ARB_XPU_PRT7_WACR0_ADDR A:0x6200e5a0
y.create.l HWIO_PMIC_ARB_XPU_PRT8_WACR0_ADDR A:0x6200e620
y.create.l HWIO_PMIC_ARB_XPU_PRT9_WACR0_ADDR A:0x6200e6a0
y.create.l HWIO_PMIC_ARB_XPU_PRT0_START0_ADDR A:0x6200e240
y.create.l HWIO_PMIC_ARB_XPU_PRT1_START0_ADDR A:0x6200e2c0
y.create.l HWIO_PMIC_ARB_XPU_PRT2_START0_ADDR A:0x6200e340
y.create.l HWIO_PMIC_ARB_XPU_PRT3_START0_ADDR A:0x6200e3c0
y.create.l HWIO_PMIC_ARB_XPU_PRT4_START0_ADDR A:0x6200e440
y.create.l HWIO_PMIC_ARB_XPU_PRT5_START0_ADDR A:0x6200e4c0
y.create.l HWIO_PMIC_ARB_XPU_PRT6_START0_ADDR A:0x6200e540
y.create.l HWIO_PMIC_ARB_XPU_PRT7_START0_ADDR A:0x6200e5c0
y.create.l HWIO_PMIC_ARB_XPU_PRT8_START0_ADDR A:0x6200e640
y.create.l HWIO_PMIC_ARB_XPU_PRT9_START0_ADDR A:0x6200e6c0
y.create.l HWIO_PMIC_ARB_XPU_PRT0_END0_ADDR A:0x6200e248
y.create.l HWIO_PMIC_ARB_XPU_PRT1_END0_ADDR A:0x6200e2c8
y.create.l HWIO_PMIC_ARB_XPU_PRT2_END0_ADDR A:0x6200e348
y.create.l HWIO_PMIC_ARB_XPU_PRT3_END0_ADDR A:0x6200e3c8
y.create.l HWIO_PMIC_ARB_XPU_PRT4_END0_ADDR A:0x6200e448
y.create.l HWIO_PMIC_ARB_XPU_PRT5_END0_ADDR A:0x6200e4c8
y.create.l HWIO_PMIC_ARB_XPU_PRT6_END0_ADDR A:0x6200e548
y.create.l HWIO_PMIC_ARB_XPU_PRT7_END0_ADDR A:0x6200e5c8
y.create.l HWIO_PMIC_ARB_XPU_PRT8_END0_ADDR A:0x6200e648
y.create.l HWIO_PMIC_ARB_XPU_PRT9_END0_ADDR A:0x6200e6c8
y.create.l HWIO_PMIC_ARB_XPU_PRT0_SCR_ADDR A:0x6200e250
y.create.l HWIO_PMIC_ARB_XPU_PRT1_SCR_ADDR A:0x6200e2d0
y.create.l HWIO_PMIC_ARB_XPU_PRT2_SCR_ADDR A:0x6200e350
y.create.l HWIO_PMIC_ARB_XPU_PRT3_SCR_ADDR A:0x6200e3d0
y.create.l HWIO_PMIC_ARB_XPU_PRT4_SCR_ADDR A:0x6200e450
y.create.l HWIO_PMIC_ARB_XPU_PRT5_SCR_ADDR A:0x6200e4d0
y.create.l HWIO_PMIC_ARB_XPU_PRT6_SCR_ADDR A:0x6200e550
y.create.l HWIO_PMIC_ARB_XPU_PRT7_SCR_ADDR A:0x6200e5d0
y.create.l HWIO_PMIC_ARB_XPU_PRT8_SCR_ADDR A:0x6200e650
y.create.l HWIO_PMIC_ARB_XPU_PRT9_SCR_ADDR A:0x6200e6d0
y.create.l HWIO_PMIC_ARB_XPU_PRT0_MCR_ADDR A:0x6200e254
y.create.l HWIO_PMIC_ARB_XPU_PRT1_MCR_ADDR A:0x6200e2d4
y.create.l HWIO_PMIC_ARB_XPU_PRT2_MCR_ADDR A:0x6200e354
y.create.l HWIO_PMIC_ARB_XPU_PRT3_MCR_ADDR A:0x6200e3d4
y.create.l HWIO_PMIC_ARB_XPU_PRT4_MCR_ADDR A:0x6200e454
y.create.l HWIO_PMIC_ARB_XPU_PRT5_MCR_ADDR A:0x6200e4d4
y.create.l HWIO_PMIC_ARB_XPU_PRT6_MCR_ADDR A:0x6200e554
y.create.l HWIO_PMIC_ARB_XPU_PRT7_MCR_ADDR A:0x6200e5d4
y.create.l HWIO_PMIC_ARB_XPU_PRT8_MCR_ADDR A:0x6200e654
y.create.l HWIO_PMIC_ARB_XPU_PRT9_MCR_ADDR A:0x6200e6d4
y.create.l HWIO_PMIC_ARB_XPU_PRT0_CNTL0_ADDR A:0x6200e258
y.create.l HWIO_PMIC_ARB_XPU_PRT1_CNTL0_ADDR A:0x6200e2d8
y.create.l HWIO_PMIC_ARB_XPU_PRT2_CNTL0_ADDR A:0x6200e358
y.create.l HWIO_PMIC_ARB_XPU_PRT3_CNTL0_ADDR A:0x6200e3d8
y.create.l HWIO_PMIC_ARB_XPU_PRT4_CNTL0_ADDR A:0x6200e458
y.create.l HWIO_PMIC_ARB_XPU_PRT5_CNTL0_ADDR A:0x6200e4d8
y.create.l HWIO_PMIC_ARB_XPU_PRT6_CNTL0_ADDR A:0x6200e558
y.create.l HWIO_PMIC_ARB_XPU_PRT7_CNTL0_ADDR A:0x6200e5d8
y.create.l HWIO_PMIC_ARB_XPU_PRT8_CNTL0_ADDR A:0x6200e658
y.create.l HWIO_PMIC_ARB_XPU_PRT9_CNTL0_ADDR A:0x6200e6d8
y.create.l HWIO_PMIC_ARB_XPU_PRT0_CNTL1_ADDR A:0x6200e25c
y.create.l HWIO_PMIC_ARB_XPU_PRT1_CNTL1_ADDR A:0x6200e2dc
y.create.l HWIO_PMIC_ARB_XPU_PRT2_CNTL1_ADDR A:0x6200e35c
y.create.l HWIO_PMIC_ARB_XPU_PRT3_CNTL1_ADDR A:0x6200e3dc
y.create.l HWIO_PMIC_ARB_XPU_PRT4_CNTL1_ADDR A:0x6200e45c
y.create.l HWIO_PMIC_ARB_XPU_PRT5_CNTL1_ADDR A:0x6200e4dc
y.create.l HWIO_PMIC_ARB_XPU_PRT6_CNTL1_ADDR A:0x6200e55c
y.create.l HWIO_PMIC_ARB_XPU_PRT7_CNTL1_ADDR A:0x6200e5dc
y.create.l HWIO_PMIC_ARB_XPU_PRT8_CNTL1_ADDR A:0x6200e65c
y.create.l HWIO_PMIC_ARB_XPU_PRT9_CNTL1_ADDR A:0x6200e6dc
y.create.l HWIO_PMIC_ARB_HW_VERSION_ADDR A:0x6200f000
y.create.l HWIO_PMIC_ARB_MISC_CONFIG_ADDR A:0x6200f004
y.create.l HWIO_PMIC_ARB_PVC_INTF_CTL_ADDR A:0x6200f008
y.create.l HWIO_PMIC_ARB_PVC_INTF_STATUS_ADDR A:0x6200f00c
y.create.l HWIO_PMIC_ARB_PRIORITIES0_ADDR A:0x6200f100
y.create.l HWIO_PMIC_ARB_PRIORITIES1_ADDR A:0x6200f104
y.create.l HWIO_PMIC_ARB_PRIORITIES2_ADDR A:0x6200f108
y.create.l HWIO_PMIC_ARB_PRIORITIES3_ADDR A:0x6200f10c
y.create.l HWIO_PMIC_ARB_PRIORITIES4_ADDR A:0x6200f110
y.create.l HWIO_PMIC_ARB_PRIORITIES5_ADDR A:0x6200f114
y.create.l HWIO_PMIC_ARB_PRIORITIES6_ADDR A:0x6200f118
y.create.l HWIO_PMIC_ARB_PVC_PORT0_CTL_ADDR A:0x6200f200
y.create.l HWIO_PMIC_ARB_PVC_PORT1_CTL_ADDR A:0x6200f204
y.create.l HWIO_PMIC_ARB_PVC_PORT2_CTL_ADDR A:0x6200f208
y.create.l HWIO_PMIC_ARB_PVC_PORT3_CTL_ADDR A:0x6200f20c
y.create.l HWIO_PMIC_ARB_PVC_PORT4_CTL_ADDR A:0x6200f210
y.create.l HWIO_PMIC_ARB_PVC_PORT5_CTL_ADDR A:0x6200f214
y.create.l HWIO_PMIC_ARB_PVC_PORT0_STATUS_ADDR A:0x6200f280
y.create.l HWIO_PMIC_ARB_PVC_PORT1_STATUS_ADDR A:0x6200f284
y.create.l HWIO_PMIC_ARB_PVC_PORT2_STATUS_ADDR A:0x6200f288
y.create.l HWIO_PMIC_ARB_PVC_PORT3_STATUS_ADDR A:0x6200f28c
y.create.l HWIO_PMIC_ARB_PVC_PORT4_STATUS_ADDR A:0x6200f290
y.create.l HWIO_PMIC_ARB_PVC_PORT5_STATUS_ADDR A:0x6200f294
y.create.l HWIO_PMIC_ARB_PVC0_ADDR0_ADDR A:0x6200f400
y.create.l HWIO_PMIC_ARB_PVC0_ADDR1_ADDR A:0x6200f404
y.create.l HWIO_PMIC_ARB_PVC0_ADDR2_ADDR A:0x6200f408
y.create.l HWIO_PMIC_ARB_PVC0_ADDR3_ADDR A:0x6200f40c
y.create.l HWIO_PMIC_ARB_PVC1_ADDR0_ADDR A:0x6200f420
y.create.l HWIO_PMIC_ARB_PVC1_ADDR1_ADDR A:0x6200f424
y.create.l HWIO_PMIC_ARB_PVC1_ADDR2_ADDR A:0x6200f428
y.create.l HWIO_PMIC_ARB_PVC1_ADDR3_ADDR A:0x6200f42c
y.create.l HWIO_PMIC_ARB_PVC2_ADDR0_ADDR A:0x6200f440
y.create.l HWIO_PMIC_ARB_PVC2_ADDR1_ADDR A:0x6200f444
y.create.l HWIO_PMIC_ARB_PVC2_ADDR2_ADDR A:0x6200f448
y.create.l HWIO_PMIC_ARB_PVC2_ADDR3_ADDR A:0x6200f44c
y.create.l HWIO_PMIC_ARB_PVC3_ADDR0_ADDR A:0x6200f460
y.create.l HWIO_PMIC_ARB_PVC3_ADDR1_ADDR A:0x6200f464
y.create.l HWIO_PMIC_ARB_PVC3_ADDR2_ADDR A:0x6200f468
y.create.l HWIO_PMIC_ARB_PVC3_ADDR3_ADDR A:0x6200f46c
y.create.l HWIO_PMIC_ARB_PVC4_ADDR0_ADDR A:0x6200f480
y.create.l HWIO_PMIC_ARB_PVC4_ADDR1_ADDR A:0x6200f484
y.create.l HWIO_PMIC_ARB_PVC4_ADDR2_ADDR A:0x6200f488
y.create.l HWIO_PMIC_ARB_PVC4_ADDR3_ADDR A:0x6200f48c
y.create.l HWIO_PMIC_ARB_PVC5_ADDR0_ADDR A:0x6200f4a0
y.create.l HWIO_PMIC_ARB_PVC5_ADDR1_ADDR A:0x6200f4a4
y.create.l HWIO_PMIC_ARB_PVC5_ADDR2_ADDR A:0x6200f4a8
y.create.l HWIO_PMIC_ARB_PVC5_ADDR3_ADDR A:0x6200f4ac
y.create.l HWIO_PMIC_ARB_REG_CHNL0_ADDR A:0x6200f800
y.create.l HWIO_PMIC_ARB_REG_CHNL1_ADDR A:0x6200f804
y.create.l HWIO_PMIC_ARB_REG_CHNL2_ADDR A:0x6200f808
y.create.l HWIO_PMIC_ARB_REG_CHNL3_ADDR A:0x6200f80c
y.create.l HWIO_PMIC_ARB_REG_CHNL4_ADDR A:0x6200f810
y.create.l HWIO_PMIC_ARB_REG_CHNL5_ADDR A:0x6200f814
y.create.l HWIO_PMIC_ARB_REG_CHNL6_ADDR A:0x6200f818
y.create.l HWIO_PMIC_ARB_REG_CHNL7_ADDR A:0x6200f81c
y.create.l HWIO_PMIC_ARB_REG_CHNL8_ADDR A:0x6200f820
y.create.l HWIO_PMIC_ARB_REG_CHNL9_ADDR A:0x6200f824
y.create.l HWIO_PMIC_ARB0_CHNL0_CMD_ADDR A:0x62400000
y.create.l HWIO_PMIC_ARB0_CHNL1_CMD_ADDR A:0x62408000
y.create.l HWIO_PMIC_ARB0_CHNL2_CMD_ADDR A:0x62410000
y.create.l HWIO_PMIC_ARB0_CHNL3_CMD_ADDR A:0x62418000
y.create.l HWIO_PMIC_ARB1_CHNL0_CMD_ADDR A:0x62401000
y.create.l HWIO_PMIC_ARB1_CHNL1_CMD_ADDR A:0x62409000
y.create.l HWIO_PMIC_ARB1_CHNL2_CMD_ADDR A:0x62411000
y.create.l HWIO_PMIC_ARB1_CHNL3_CMD_ADDR A:0x62419000
y.create.l HWIO_PMIC_ARB2_CHNL0_CMD_ADDR A:0x62402000
y.create.l HWIO_PMIC_ARB2_CHNL1_CMD_ADDR A:0x6240a000
y.create.l HWIO_PMIC_ARB2_CHNL2_CMD_ADDR A:0x62412000
y.create.l HWIO_PMIC_ARB2_CHNL3_CMD_ADDR A:0x6241a000
y.create.l HWIO_PMIC_ARB3_CHNL0_CMD_ADDR A:0x62403000
y.create.l HWIO_PMIC_ARB3_CHNL1_CMD_ADDR A:0x6240b000
y.create.l HWIO_PMIC_ARB3_CHNL2_CMD_ADDR A:0x62413000
y.create.l HWIO_PMIC_ARB3_CHNL3_CMD_ADDR A:0x6241b000
y.create.l HWIO_PMIC_ARB4_CHNL0_CMD_ADDR A:0x62404000
y.create.l HWIO_PMIC_ARB4_CHNL1_CMD_ADDR A:0x6240c000
y.create.l HWIO_PMIC_ARB4_CHNL2_CMD_ADDR A:0x62414000
y.create.l HWIO_PMIC_ARB4_CHNL3_CMD_ADDR A:0x6241c000
y.create.l HWIO_PMIC_ARB5_CHNL0_CMD_ADDR A:0x62405000
y.create.l HWIO_PMIC_ARB5_CHNL1_CMD_ADDR A:0x6240d000
y.create.l HWIO_PMIC_ARB5_CHNL2_CMD_ADDR A:0x62415000
y.create.l HWIO_PMIC_ARB5_CHNL3_CMD_ADDR A:0x6241d000
y.create.l HWIO_PMIC_ARB0_CHNL0_CONFIG_ADDR A:0x62400004
y.create.l HWIO_PMIC_ARB0_CHNL1_CONFIG_ADDR A:0x62408004
y.create.l HWIO_PMIC_ARB0_CHNL2_CONFIG_ADDR A:0x62410004
y.create.l HWIO_PMIC_ARB0_CHNL3_CONFIG_ADDR A:0x62418004
y.create.l HWIO_PMIC_ARB1_CHNL0_CONFIG_ADDR A:0x62401004
y.create.l HWIO_PMIC_ARB1_CHNL1_CONFIG_ADDR A:0x62409004
y.create.l HWIO_PMIC_ARB1_CHNL2_CONFIG_ADDR A:0x62411004
y.create.l HWIO_PMIC_ARB1_CHNL3_CONFIG_ADDR A:0x62419004
y.create.l HWIO_PMIC_ARB2_CHNL0_CONFIG_ADDR A:0x62402004
y.create.l HWIO_PMIC_ARB2_CHNL1_CONFIG_ADDR A:0x6240a004
y.create.l HWIO_PMIC_ARB2_CHNL2_CONFIG_ADDR A:0x62412004
y.create.l HWIO_PMIC_ARB2_CHNL3_CONFIG_ADDR A:0x6241a004
y.create.l HWIO_PMIC_ARB3_CHNL0_CONFIG_ADDR A:0x62403004
y.create.l HWIO_PMIC_ARB3_CHNL1_CONFIG_ADDR A:0x6240b004
y.create.l HWIO_PMIC_ARB3_CHNL2_CONFIG_ADDR A:0x62413004
y.create.l HWIO_PMIC_ARB3_CHNL3_CONFIG_ADDR A:0x6241b004
y.create.l HWIO_PMIC_ARB4_CHNL0_CONFIG_ADDR A:0x62404004
y.create.l HWIO_PMIC_ARB4_CHNL1_CONFIG_ADDR A:0x6240c004
y.create.l HWIO_PMIC_ARB4_CHNL2_CONFIG_ADDR A:0x62414004
y.create.l HWIO_PMIC_ARB4_CHNL3_CONFIG_ADDR A:0x6241c004
y.create.l HWIO_PMIC_ARB5_CHNL0_CONFIG_ADDR A:0x62405004
y.create.l HWIO_PMIC_ARB5_CHNL1_CONFIG_ADDR A:0x6240d004
y.create.l HWIO_PMIC_ARB5_CHNL2_CONFIG_ADDR A:0x62415004
y.create.l HWIO_PMIC_ARB5_CHNL3_CONFIG_ADDR A:0x6241d004
y.create.l HWIO_PMIC_ARB0_CHNL0_STATUS_ADDR A:0x62400008
y.create.l HWIO_PMIC_ARB0_CHNL1_STATUS_ADDR A:0x62408008
y.create.l HWIO_PMIC_ARB0_CHNL2_STATUS_ADDR A:0x62410008
y.create.l HWIO_PMIC_ARB0_CHNL3_STATUS_ADDR A:0x62418008
y.create.l HWIO_PMIC_ARB1_CHNL0_STATUS_ADDR A:0x62401008
y.create.l HWIO_PMIC_ARB1_CHNL1_STATUS_ADDR A:0x62409008
y.create.l HWIO_PMIC_ARB1_CHNL2_STATUS_ADDR A:0x62411008
y.create.l HWIO_PMIC_ARB1_CHNL3_STATUS_ADDR A:0x62419008
y.create.l HWIO_PMIC_ARB2_CHNL0_STATUS_ADDR A:0x62402008
y.create.l HWIO_PMIC_ARB2_CHNL1_STATUS_ADDR A:0x6240a008
y.create.l HWIO_PMIC_ARB2_CHNL2_STATUS_ADDR A:0x62412008
y.create.l HWIO_PMIC_ARB2_CHNL3_STATUS_ADDR A:0x6241a008
y.create.l HWIO_PMIC_ARB3_CHNL0_STATUS_ADDR A:0x62403008
y.create.l HWIO_PMIC_ARB3_CHNL1_STATUS_ADDR A:0x6240b008
y.create.l HWIO_PMIC_ARB3_CHNL2_STATUS_ADDR A:0x62413008
y.create.l HWIO_PMIC_ARB3_CHNL3_STATUS_ADDR A:0x6241b008
y.create.l HWIO_PMIC_ARB4_CHNL0_STATUS_ADDR A:0x62404008
y.create.l HWIO_PMIC_ARB4_CHNL1_STATUS_ADDR A:0x6240c008
y.create.l HWIO_PMIC_ARB4_CHNL2_STATUS_ADDR A:0x62414008
y.create.l HWIO_PMIC_ARB4_CHNL3_STATUS_ADDR A:0x6241c008
y.create.l HWIO_PMIC_ARB5_CHNL0_STATUS_ADDR A:0x62405008
y.create.l HWIO_PMIC_ARB5_CHNL1_STATUS_ADDR A:0x6240d008
y.create.l HWIO_PMIC_ARB5_CHNL2_STATUS_ADDR A:0x62415008
y.create.l HWIO_PMIC_ARB5_CHNL3_STATUS_ADDR A:0x6241d008
y.create.l HWIO_PMIC_ARB0_CHNL0_WDATA0_ADDR A:0x62400010
y.create.l HWIO_PMIC_ARB0_CHNL1_WDATA0_ADDR A:0x62408010
y.create.l HWIO_PMIC_ARB0_CHNL2_WDATA0_ADDR A:0x62410010
y.create.l HWIO_PMIC_ARB0_CHNL3_WDATA0_ADDR A:0x62418010
y.create.l HWIO_PMIC_ARB1_CHNL0_WDATA0_ADDR A:0x62401010
y.create.l HWIO_PMIC_ARB1_CHNL1_WDATA0_ADDR A:0x62409010
y.create.l HWIO_PMIC_ARB1_CHNL2_WDATA0_ADDR A:0x62411010
y.create.l HWIO_PMIC_ARB1_CHNL3_WDATA0_ADDR A:0x62419010
y.create.l HWIO_PMIC_ARB2_CHNL0_WDATA0_ADDR A:0x62402010
y.create.l HWIO_PMIC_ARB2_CHNL1_WDATA0_ADDR A:0x6240a010
y.create.l HWIO_PMIC_ARB2_CHNL2_WDATA0_ADDR A:0x62412010
y.create.l HWIO_PMIC_ARB2_CHNL3_WDATA0_ADDR A:0x6241a010
y.create.l HWIO_PMIC_ARB3_CHNL0_WDATA0_ADDR A:0x62403010
y.create.l HWIO_PMIC_ARB3_CHNL1_WDATA0_ADDR A:0x6240b010
y.create.l HWIO_PMIC_ARB3_CHNL2_WDATA0_ADDR A:0x62413010
y.create.l HWIO_PMIC_ARB3_CHNL3_WDATA0_ADDR A:0x6241b010
y.create.l HWIO_PMIC_ARB4_CHNL0_WDATA0_ADDR A:0x62404010
y.create.l HWIO_PMIC_ARB4_CHNL1_WDATA0_ADDR A:0x6240c010
y.create.l HWIO_PMIC_ARB4_CHNL2_WDATA0_ADDR A:0x62414010
y.create.l HWIO_PMIC_ARB4_CHNL3_WDATA0_ADDR A:0x6241c010
y.create.l HWIO_PMIC_ARB5_CHNL0_WDATA0_ADDR A:0x62405010
y.create.l HWIO_PMIC_ARB5_CHNL1_WDATA0_ADDR A:0x6240d010
y.create.l HWIO_PMIC_ARB5_CHNL2_WDATA0_ADDR A:0x62415010
y.create.l HWIO_PMIC_ARB5_CHNL3_WDATA0_ADDR A:0x6241d010
y.create.l HWIO_PMIC_ARB0_CHNL0_WDATA1_ADDR A:0x62400014
y.create.l HWIO_PMIC_ARB0_CHNL1_WDATA1_ADDR A:0x62408014
y.create.l HWIO_PMIC_ARB0_CHNL2_WDATA1_ADDR A:0x62410014
y.create.l HWIO_PMIC_ARB0_CHNL3_WDATA1_ADDR A:0x62418014
y.create.l HWIO_PMIC_ARB1_CHNL0_WDATA1_ADDR A:0x62401014
y.create.l HWIO_PMIC_ARB1_CHNL1_WDATA1_ADDR A:0x62409014
y.create.l HWIO_PMIC_ARB1_CHNL2_WDATA1_ADDR A:0x62411014
y.create.l HWIO_PMIC_ARB1_CHNL3_WDATA1_ADDR A:0x62419014
y.create.l HWIO_PMIC_ARB2_CHNL0_WDATA1_ADDR A:0x62402014
y.create.l HWIO_PMIC_ARB2_CHNL1_WDATA1_ADDR A:0x6240a014
y.create.l HWIO_PMIC_ARB2_CHNL2_WDATA1_ADDR A:0x62412014
y.create.l HWIO_PMIC_ARB2_CHNL3_WDATA1_ADDR A:0x6241a014
y.create.l HWIO_PMIC_ARB3_CHNL0_WDATA1_ADDR A:0x62403014
y.create.l HWIO_PMIC_ARB3_CHNL1_WDATA1_ADDR A:0x6240b014
y.create.l HWIO_PMIC_ARB3_CHNL2_WDATA1_ADDR A:0x62413014
y.create.l HWIO_PMIC_ARB3_CHNL3_WDATA1_ADDR A:0x6241b014
y.create.l HWIO_PMIC_ARB4_CHNL0_WDATA1_ADDR A:0x62404014
y.create.l HWIO_PMIC_ARB4_CHNL1_WDATA1_ADDR A:0x6240c014
y.create.l HWIO_PMIC_ARB4_CHNL2_WDATA1_ADDR A:0x62414014
y.create.l HWIO_PMIC_ARB4_CHNL3_WDATA1_ADDR A:0x6241c014
y.create.l HWIO_PMIC_ARB5_CHNL0_WDATA1_ADDR A:0x62405014
y.create.l HWIO_PMIC_ARB5_CHNL1_WDATA1_ADDR A:0x6240d014
y.create.l HWIO_PMIC_ARB5_CHNL2_WDATA1_ADDR A:0x62415014
y.create.l HWIO_PMIC_ARB5_CHNL3_WDATA1_ADDR A:0x6241d014
y.create.l HWIO_PMIC_ARB0_CHNL0_RDATA0_ADDR A:0x62400018
y.create.l HWIO_PMIC_ARB0_CHNL1_RDATA0_ADDR A:0x62408018
y.create.l HWIO_PMIC_ARB0_CHNL2_RDATA0_ADDR A:0x62410018
y.create.l HWIO_PMIC_ARB0_CHNL3_RDATA0_ADDR A:0x62418018
y.create.l HWIO_PMIC_ARB1_CHNL0_RDATA0_ADDR A:0x62401018
y.create.l HWIO_PMIC_ARB1_CHNL1_RDATA0_ADDR A:0x62409018
y.create.l HWIO_PMIC_ARB1_CHNL2_RDATA0_ADDR A:0x62411018
y.create.l HWIO_PMIC_ARB1_CHNL3_RDATA0_ADDR A:0x62419018
y.create.l HWIO_PMIC_ARB2_CHNL0_RDATA0_ADDR A:0x62402018
y.create.l HWIO_PMIC_ARB2_CHNL1_RDATA0_ADDR A:0x6240a018
y.create.l HWIO_PMIC_ARB2_CHNL2_RDATA0_ADDR A:0x62412018
y.create.l HWIO_PMIC_ARB2_CHNL3_RDATA0_ADDR A:0x6241a018
y.create.l HWIO_PMIC_ARB3_CHNL0_RDATA0_ADDR A:0x62403018
y.create.l HWIO_PMIC_ARB3_CHNL1_RDATA0_ADDR A:0x6240b018
y.create.l HWIO_PMIC_ARB3_CHNL2_RDATA0_ADDR A:0x62413018
y.create.l HWIO_PMIC_ARB3_CHNL3_RDATA0_ADDR A:0x6241b018
y.create.l HWIO_PMIC_ARB4_CHNL0_RDATA0_ADDR A:0x62404018
y.create.l HWIO_PMIC_ARB4_CHNL1_RDATA0_ADDR A:0x6240c018
y.create.l HWIO_PMIC_ARB4_CHNL2_RDATA0_ADDR A:0x62414018
y.create.l HWIO_PMIC_ARB4_CHNL3_RDATA0_ADDR A:0x6241c018
y.create.l HWIO_PMIC_ARB5_CHNL0_RDATA0_ADDR A:0x62405018
y.create.l HWIO_PMIC_ARB5_CHNL1_RDATA0_ADDR A:0x6240d018
y.create.l HWIO_PMIC_ARB5_CHNL2_RDATA0_ADDR A:0x62415018
y.create.l HWIO_PMIC_ARB5_CHNL3_RDATA0_ADDR A:0x6241d018
y.create.l HWIO_PMIC_ARB0_CHNL0_RDATA1_ADDR A:0x6240001c
y.create.l HWIO_PMIC_ARB0_CHNL1_RDATA1_ADDR A:0x6240801c
y.create.l HWIO_PMIC_ARB0_CHNL2_RDATA1_ADDR A:0x6241001c
y.create.l HWIO_PMIC_ARB0_CHNL3_RDATA1_ADDR A:0x6241801c
y.create.l HWIO_PMIC_ARB1_CHNL0_RDATA1_ADDR A:0x6240101c
y.create.l HWIO_PMIC_ARB1_CHNL1_RDATA1_ADDR A:0x6240901c
y.create.l HWIO_PMIC_ARB1_CHNL2_RDATA1_ADDR A:0x6241101c
y.create.l HWIO_PMIC_ARB1_CHNL3_RDATA1_ADDR A:0x6241901c
y.create.l HWIO_PMIC_ARB2_CHNL0_RDATA1_ADDR A:0x6240201c
y.create.l HWIO_PMIC_ARB2_CHNL1_RDATA1_ADDR A:0x6240a01c
y.create.l HWIO_PMIC_ARB2_CHNL2_RDATA1_ADDR A:0x6241201c
y.create.l HWIO_PMIC_ARB2_CHNL3_RDATA1_ADDR A:0x6241a01c
y.create.l HWIO_PMIC_ARB3_CHNL0_RDATA1_ADDR A:0x6240301c
y.create.l HWIO_PMIC_ARB3_CHNL1_RDATA1_ADDR A:0x6240b01c
y.create.l HWIO_PMIC_ARB3_CHNL2_RDATA1_ADDR A:0x6241301c
y.create.l HWIO_PMIC_ARB3_CHNL3_RDATA1_ADDR A:0x6241b01c
y.create.l HWIO_PMIC_ARB4_CHNL0_RDATA1_ADDR A:0x6240401c
y.create.l HWIO_PMIC_ARB4_CHNL1_RDATA1_ADDR A:0x6240c01c
y.create.l HWIO_PMIC_ARB4_CHNL2_RDATA1_ADDR A:0x6241401c
y.create.l HWIO_PMIC_ARB4_CHNL3_RDATA1_ADDR A:0x6241c01c
y.create.l HWIO_PMIC_ARB5_CHNL0_RDATA1_ADDR A:0x6240501c
y.create.l HWIO_PMIC_ARB5_CHNL1_RDATA1_ADDR A:0x6240d01c
y.create.l HWIO_PMIC_ARB5_CHNL2_RDATA1_ADDR A:0x6241501c
y.create.l HWIO_PMIC_ARB5_CHNL3_RDATA1_ADDR A:0x6241d01c
y.create.l HWIO_PMIC_ARB0_CHNL0_RDATA2_ADDR A:0x62400020
y.create.l HWIO_PMIC_ARB0_CHNL1_RDATA2_ADDR A:0x62408020
y.create.l HWIO_PMIC_ARB0_CHNL2_RDATA2_ADDR A:0x62410020
y.create.l HWIO_PMIC_ARB0_CHNL3_RDATA2_ADDR A:0x62418020
y.create.l HWIO_PMIC_ARB1_CHNL0_RDATA2_ADDR A:0x62401020
y.create.l HWIO_PMIC_ARB1_CHNL1_RDATA2_ADDR A:0x62409020
y.create.l HWIO_PMIC_ARB1_CHNL2_RDATA2_ADDR A:0x62411020
y.create.l HWIO_PMIC_ARB1_CHNL3_RDATA2_ADDR A:0x62419020
y.create.l HWIO_PMIC_ARB2_CHNL0_RDATA2_ADDR A:0x62402020
y.create.l HWIO_PMIC_ARB2_CHNL1_RDATA2_ADDR A:0x6240a020
y.create.l HWIO_PMIC_ARB2_CHNL2_RDATA2_ADDR A:0x62412020
y.create.l HWIO_PMIC_ARB2_CHNL3_RDATA2_ADDR A:0x6241a020
y.create.l HWIO_PMIC_ARB3_CHNL0_RDATA2_ADDR A:0x62403020
y.create.l HWIO_PMIC_ARB3_CHNL1_RDATA2_ADDR A:0x6240b020
y.create.l HWIO_PMIC_ARB3_CHNL2_RDATA2_ADDR A:0x62413020
y.create.l HWIO_PMIC_ARB3_CHNL3_RDATA2_ADDR A:0x6241b020
y.create.l HWIO_PMIC_ARB4_CHNL0_RDATA2_ADDR A:0x62404020
y.create.l HWIO_PMIC_ARB4_CHNL1_RDATA2_ADDR A:0x6240c020
y.create.l HWIO_PMIC_ARB4_CHNL2_RDATA2_ADDR A:0x62414020
y.create.l HWIO_PMIC_ARB4_CHNL3_RDATA2_ADDR A:0x6241c020
y.create.l HWIO_PMIC_ARB5_CHNL0_RDATA2_ADDR A:0x62405020
y.create.l HWIO_PMIC_ARB5_CHNL1_RDATA2_ADDR A:0x6240d020
y.create.l HWIO_PMIC_ARB5_CHNL2_RDATA2_ADDR A:0x62415020
y.create.l HWIO_PMIC_ARB5_CHNL3_RDATA2_ADDR A:0x6241d020
y.create.l HWIO_PMIC_ARB_OBS0_CHNL0_CMD_ADDR A:0x62c00000
y.create.l HWIO_PMIC_ARB_OBS0_CHNL1_CMD_ADDR A:0x62c08000
y.create.l HWIO_PMIC_ARB_OBS0_CHNL2_CMD_ADDR A:0x62c10000
y.create.l HWIO_PMIC_ARB_OBS0_CHNL3_CMD_ADDR A:0x62c18000
y.create.l HWIO_PMIC_ARB_OBS1_CHNL0_CMD_ADDR A:0x62c01000
y.create.l HWIO_PMIC_ARB_OBS1_CHNL1_CMD_ADDR A:0x62c09000
y.create.l HWIO_PMIC_ARB_OBS1_CHNL2_CMD_ADDR A:0x62c11000
y.create.l HWIO_PMIC_ARB_OBS1_CHNL3_CMD_ADDR A:0x62c19000
y.create.l HWIO_PMIC_ARB_OBS2_CHNL0_CMD_ADDR A:0x62c02000
y.create.l HWIO_PMIC_ARB_OBS2_CHNL1_CMD_ADDR A:0x62c0a000
y.create.l HWIO_PMIC_ARB_OBS2_CHNL2_CMD_ADDR A:0x62c12000
y.create.l HWIO_PMIC_ARB_OBS2_CHNL3_CMD_ADDR A:0x62c1a000
y.create.l HWIO_PMIC_ARB_OBS3_CHNL0_CMD_ADDR A:0x62c03000
y.create.l HWIO_PMIC_ARB_OBS3_CHNL1_CMD_ADDR A:0x62c0b000
y.create.l HWIO_PMIC_ARB_OBS3_CHNL2_CMD_ADDR A:0x62c13000
y.create.l HWIO_PMIC_ARB_OBS3_CHNL3_CMD_ADDR A:0x62c1b000
y.create.l HWIO_PMIC_ARB_OBS4_CHNL0_CMD_ADDR A:0x62c04000
y.create.l HWIO_PMIC_ARB_OBS4_CHNL1_CMD_ADDR A:0x62c0c000
y.create.l HWIO_PMIC_ARB_OBS4_CHNL2_CMD_ADDR A:0x62c14000
y.create.l HWIO_PMIC_ARB_OBS4_CHNL3_CMD_ADDR A:0x62c1c000
y.create.l HWIO_PMIC_ARB_OBS5_CHNL0_CMD_ADDR A:0x62c05000
y.create.l HWIO_PMIC_ARB_OBS5_CHNL1_CMD_ADDR A:0x62c0d000
y.create.l HWIO_PMIC_ARB_OBS5_CHNL2_CMD_ADDR A:0x62c15000
y.create.l HWIO_PMIC_ARB_OBS5_CHNL3_CMD_ADDR A:0x62c1d000
y.create.l HWIO_PMIC_ARB_OBS0_CHNL0_CONFIG_ADDR A:0x62c00004
y.create.l HWIO_PMIC_ARB_OBS0_CHNL1_CONFIG_ADDR A:0x62c08004
y.create.l HWIO_PMIC_ARB_OBS0_CHNL2_CONFIG_ADDR A:0x62c10004
y.create.l HWIO_PMIC_ARB_OBS0_CHNL3_CONFIG_ADDR A:0x62c18004
y.create.l HWIO_PMIC_ARB_OBS1_CHNL0_CONFIG_ADDR A:0x62c01004
y.create.l HWIO_PMIC_ARB_OBS1_CHNL1_CONFIG_ADDR A:0x62c09004
y.create.l HWIO_PMIC_ARB_OBS1_CHNL2_CONFIG_ADDR A:0x62c11004
y.create.l HWIO_PMIC_ARB_OBS1_CHNL3_CONFIG_ADDR A:0x62c19004
y.create.l HWIO_PMIC_ARB_OBS2_CHNL0_CONFIG_ADDR A:0x62c02004
y.create.l HWIO_PMIC_ARB_OBS2_CHNL1_CONFIG_ADDR A:0x62c0a004
y.create.l HWIO_PMIC_ARB_OBS2_CHNL2_CONFIG_ADDR A:0x62c12004
y.create.l HWIO_PMIC_ARB_OBS2_CHNL3_CONFIG_ADDR A:0x62c1a004
y.create.l HWIO_PMIC_ARB_OBS3_CHNL0_CONFIG_ADDR A:0x62c03004
y.create.l HWIO_PMIC_ARB_OBS3_CHNL1_CONFIG_ADDR A:0x62c0b004
y.create.l HWIO_PMIC_ARB_OBS3_CHNL2_CONFIG_ADDR A:0x62c13004
y.create.l HWIO_PMIC_ARB_OBS3_CHNL3_CONFIG_ADDR A:0x62c1b004
y.create.l HWIO_PMIC_ARB_OBS4_CHNL0_CONFIG_ADDR A:0x62c04004
y.create.l HWIO_PMIC_ARB_OBS4_CHNL1_CONFIG_ADDR A:0x62c0c004
y.create.l HWIO_PMIC_ARB_OBS4_CHNL2_CONFIG_ADDR A:0x62c14004
y.create.l HWIO_PMIC_ARB_OBS4_CHNL3_CONFIG_ADDR A:0x62c1c004
y.create.l HWIO_PMIC_ARB_OBS5_CHNL0_CONFIG_ADDR A:0x62c05004
y.create.l HWIO_PMIC_ARB_OBS5_CHNL1_CONFIG_ADDR A:0x62c0d004
y.create.l HWIO_PMIC_ARB_OBS5_CHNL2_CONFIG_ADDR A:0x62c15004
y.create.l HWIO_PMIC_ARB_OBS5_CHNL3_CONFIG_ADDR A:0x62c1d004
y.create.l HWIO_PMIC_ARB_OBS0_CHNL0_STATUS_ADDR A:0x62c00008
y.create.l HWIO_PMIC_ARB_OBS0_CHNL1_STATUS_ADDR A:0x62c08008
y.create.l HWIO_PMIC_ARB_OBS0_CHNL2_STATUS_ADDR A:0x62c10008
y.create.l HWIO_PMIC_ARB_OBS0_CHNL3_STATUS_ADDR A:0x62c18008
y.create.l HWIO_PMIC_ARB_OBS1_CHNL0_STATUS_ADDR A:0x62c01008
y.create.l HWIO_PMIC_ARB_OBS1_CHNL1_STATUS_ADDR A:0x62c09008
y.create.l HWIO_PMIC_ARB_OBS1_CHNL2_STATUS_ADDR A:0x62c11008
y.create.l HWIO_PMIC_ARB_OBS1_CHNL3_STATUS_ADDR A:0x62c19008
y.create.l HWIO_PMIC_ARB_OBS2_CHNL0_STATUS_ADDR A:0x62c02008
y.create.l HWIO_PMIC_ARB_OBS2_CHNL1_STATUS_ADDR A:0x62c0a008
y.create.l HWIO_PMIC_ARB_OBS2_CHNL2_STATUS_ADDR A:0x62c12008
y.create.l HWIO_PMIC_ARB_OBS2_CHNL3_STATUS_ADDR A:0x62c1a008
y.create.l HWIO_PMIC_ARB_OBS3_CHNL0_STATUS_ADDR A:0x62c03008
y.create.l HWIO_PMIC_ARB_OBS3_CHNL1_STATUS_ADDR A:0x62c0b008
y.create.l HWIO_PMIC_ARB_OBS3_CHNL2_STATUS_ADDR A:0x62c13008
y.create.l HWIO_PMIC_ARB_OBS3_CHNL3_STATUS_ADDR A:0x62c1b008
y.create.l HWIO_PMIC_ARB_OBS4_CHNL0_STATUS_ADDR A:0x62c04008
y.create.l HWIO_PMIC_ARB_OBS4_CHNL1_STATUS_ADDR A:0x62c0c008
y.create.l HWIO_PMIC_ARB_OBS4_CHNL2_STATUS_ADDR A:0x62c14008
y.create.l HWIO_PMIC_ARB_OBS4_CHNL3_STATUS_ADDR A:0x62c1c008
y.create.l HWIO_PMIC_ARB_OBS5_CHNL0_STATUS_ADDR A:0x62c05008
y.create.l HWIO_PMIC_ARB_OBS5_CHNL1_STATUS_ADDR A:0x62c0d008
y.create.l HWIO_PMIC_ARB_OBS5_CHNL2_STATUS_ADDR A:0x62c15008
y.create.l HWIO_PMIC_ARB_OBS5_CHNL3_STATUS_ADDR A:0x62c1d008
y.create.l HWIO_PMIC_ARB_OBS0_CHNL0_RDATA0_ADDR A:0x62c00018
y.create.l HWIO_PMIC_ARB_OBS0_CHNL1_RDATA0_ADDR A:0x62c08018
y.create.l HWIO_PMIC_ARB_OBS0_CHNL2_RDATA0_ADDR A:0x62c10018
y.create.l HWIO_PMIC_ARB_OBS0_CHNL3_RDATA0_ADDR A:0x62c18018
y.create.l HWIO_PMIC_ARB_OBS1_CHNL0_RDATA0_ADDR A:0x62c01018
y.create.l HWIO_PMIC_ARB_OBS1_CHNL1_RDATA0_ADDR A:0x62c09018
y.create.l HWIO_PMIC_ARB_OBS1_CHNL2_RDATA0_ADDR A:0x62c11018
y.create.l HWIO_PMIC_ARB_OBS1_CHNL3_RDATA0_ADDR A:0x62c19018
y.create.l HWIO_PMIC_ARB_OBS2_CHNL0_RDATA0_ADDR A:0x62c02018
y.create.l HWIO_PMIC_ARB_OBS2_CHNL1_RDATA0_ADDR A:0x62c0a018
y.create.l HWIO_PMIC_ARB_OBS2_CHNL2_RDATA0_ADDR A:0x62c12018
y.create.l HWIO_PMIC_ARB_OBS2_CHNL3_RDATA0_ADDR A:0x62c1a018
y.create.l HWIO_PMIC_ARB_OBS3_CHNL0_RDATA0_ADDR A:0x62c03018
y.create.l HWIO_PMIC_ARB_OBS3_CHNL1_RDATA0_ADDR A:0x62c0b018
y.create.l HWIO_PMIC_ARB_OBS3_CHNL2_RDATA0_ADDR A:0x62c13018
y.create.l HWIO_PMIC_ARB_OBS3_CHNL3_RDATA0_ADDR A:0x62c1b018
y.create.l HWIO_PMIC_ARB_OBS4_CHNL0_RDATA0_ADDR A:0x62c04018
y.create.l HWIO_PMIC_ARB_OBS4_CHNL1_RDATA0_ADDR A:0x62c0c018
y.create.l HWIO_PMIC_ARB_OBS4_CHNL2_RDATA0_ADDR A:0x62c14018
y.create.l HWIO_PMIC_ARB_OBS4_CHNL3_RDATA0_ADDR A:0x62c1c018
y.create.l HWIO_PMIC_ARB_OBS5_CHNL0_RDATA0_ADDR A:0x62c05018
y.create.l HWIO_PMIC_ARB_OBS5_CHNL1_RDATA0_ADDR A:0x62c0d018
y.create.l HWIO_PMIC_ARB_OBS5_CHNL2_RDATA0_ADDR A:0x62c15018
y.create.l HWIO_PMIC_ARB_OBS5_CHNL3_RDATA0_ADDR A:0x62c1d018
y.create.l HWIO_PMIC_ARB_OBS0_CHNL0_RDATA1_ADDR A:0x62c0001c
y.create.l HWIO_PMIC_ARB_OBS0_CHNL1_RDATA1_ADDR A:0x62c0801c
y.create.l HWIO_PMIC_ARB_OBS0_CHNL2_RDATA1_ADDR A:0x62c1001c
y.create.l HWIO_PMIC_ARB_OBS0_CHNL3_RDATA1_ADDR A:0x62c1801c
y.create.l HWIO_PMIC_ARB_OBS1_CHNL0_RDATA1_ADDR A:0x62c0101c
y.create.l HWIO_PMIC_ARB_OBS1_CHNL1_RDATA1_ADDR A:0x62c0901c
y.create.l HWIO_PMIC_ARB_OBS1_CHNL2_RDATA1_ADDR A:0x62c1101c
y.create.l HWIO_PMIC_ARB_OBS1_CHNL3_RDATA1_ADDR A:0x62c1901c
y.create.l HWIO_PMIC_ARB_OBS2_CHNL0_RDATA1_ADDR A:0x62c0201c
y.create.l HWIO_PMIC_ARB_OBS2_CHNL1_RDATA1_ADDR A:0x62c0a01c
y.create.l HWIO_PMIC_ARB_OBS2_CHNL2_RDATA1_ADDR A:0x62c1201c
y.create.l HWIO_PMIC_ARB_OBS2_CHNL3_RDATA1_ADDR A:0x62c1a01c
y.create.l HWIO_PMIC_ARB_OBS3_CHNL0_RDATA1_ADDR A:0x62c0301c
y.create.l HWIO_PMIC_ARB_OBS3_CHNL1_RDATA1_ADDR A:0x62c0b01c
y.create.l HWIO_PMIC_ARB_OBS3_CHNL2_RDATA1_ADDR A:0x62c1301c
y.create.l HWIO_PMIC_ARB_OBS3_CHNL3_RDATA1_ADDR A:0x62c1b01c
y.create.l HWIO_PMIC_ARB_OBS4_CHNL0_RDATA1_ADDR A:0x62c0401c
y.create.l HWIO_PMIC_ARB_OBS4_CHNL1_RDATA1_ADDR A:0x62c0c01c
y.create.l HWIO_PMIC_ARB_OBS4_CHNL2_RDATA1_ADDR A:0x62c1401c
y.create.l HWIO_PMIC_ARB_OBS4_CHNL3_RDATA1_ADDR A:0x62c1c01c
y.create.l HWIO_PMIC_ARB_OBS5_CHNL0_RDATA1_ADDR A:0x62c0501c
y.create.l HWIO_PMIC_ARB_OBS5_CHNL1_RDATA1_ADDR A:0x62c0d01c
y.create.l HWIO_PMIC_ARB_OBS5_CHNL2_RDATA1_ADDR A:0x62c1501c
y.create.l HWIO_PMIC_ARB_OBS5_CHNL3_RDATA1_ADDR A:0x62c1d01c
y.create.l HWIO_PRNG_PRNG_DATA_OUT_ADDR A:0x60022000
y.create.l HWIO_PRNG_PRNG_STATUS_ADDR A:0x60022004
y.create.l HWIO_PRNG_PRNG_HW_VERSION_ADDR A:0x60022008
y.create.l HWIO_PRNG_PRNG_ENTROPY_CNTR_ADDR A:0x60022010
y.create.l HWIO_PRNG_PRNG_SAMPLE_CNTR_ADDR A:0x60022014
y.create.l HWIO_PRNG_PRNG_GEN_CNTR_ADDR A:0x60022018
y.create.l HWIO_PRNG_PRNG_RESEED_CNTR_ADDR A:0x6002201c
y.create.l HWIO_PRNG_PRNG_INSTANTIATE_CNTR_ADDR A:0x60022020
y.create.l HWIO_PRNG_PRNG_DEBUG_ADDR A:0x60022024
y.create.l HWIO_PRNG_PRNG_LFSR_CFG_ADDR A:0x60022100
y.create.l HWIO_PRNG_PRNG_CONFIG_ADDR A:0x60022104
y.create.l HWIO_PRNG_PRNG_PERSONALIZATION_STRING_ADDR A:0x60022108
y.create.l HWIO_PRNG_PRNG_NUM_ENTROPY_ADDR A:0x60022110
y.create.l HWIO_PRNG_PRNG_SAMPLE_FREQ_ADDR A:0x60022114
y.create.l HWIO_PRNG_PRNG_GEN_WORDS_ADDR A:0x60022118
y.create.l HWIO_PRNG_PRNG_RESEED_FREQ_ADDR A:0x6002211c
y.create.l HWIO_PRNG_PRNG_INSTANTIATE_FREQ_ADDR A:0x60022120
y.create.l HWIO_QDSS_CORESIGHT_CSR_ROM_WORD_ADDR A:0x66000000
y.create.l HWIO_QDSS_STM_ROM_WORD_ADDR A:0x66000004
y.create.l HWIO_QDSS_CTI0_ROM_WORD_ADDR A:0x66000008
y.create.l HWIO_QDSS_CTI1_ROM_WORD_ADDR A:0x6600000c
y.create.l HWIO_QDSS_CTI2_ROM_WORD_ADDR A:0x66000010
y.create.l HWIO_QDSS_CTI3_ROM_WORD_ADDR A:0x66000014
y.create.l HWIO_QDSS_CTI4_ROM_WORD_ADDR A:0x66000018
y.create.l HWIO_QDSS_CTI5_ROM_WORD_ADDR A:0x6600001c
y.create.l HWIO_QDSS_CTI6_ROM_WORD_ADDR A:0x66000020
y.create.l HWIO_QDSS_CTI7_ROM_WORD_ADDR A:0x66000024
y.create.l HWIO_QDSS_CTI8_ROM_WORD_ADDR A:0x66000028
y.create.l HWIO_QDSS_TPIU_ROM_WORD_ADDR A:0x6600002c
y.create.l HWIO_QDSS_TFUN0_ROM_WORD_ADDR A:0x66000030
y.create.l HWIO_QDSS_TREPL_ROM_WORD_ADDR A:0x66000034
y.create.l HWIO_QDSS_ETBETF_ROM_WORD_ADDR A:0x66000038
y.create.l HWIO_QDSS_ETR_ROM_WORD_ADDR A:0x6600003c
y.create.l HWIO_QDSS_VENUS_CTI_ROM_WORD_ADDR A:0x66000040
y.create.l HWIO_QDSS_VENUS_A9_ETM_ROM_WORD_ADDR A:0x66000044
y.create.l HWIO_QDSS_PRONTO_A9_ETM_ROM_WORD_ADDR A:0x66000048
y.create.l HWIO_QDSS_PRONTO_A9_CTI_ROM_WORD_ADDR A:0x6600004c
y.create.l HWIO_QDSS_MSS_Q6_CTI_ROM_WORD_ADDR A:0x66000050
y.create.l HWIO_QDSS_RPM_CM3_CTI_ROM_WORD_ADDR A:0x66000054
y.create.l HWIO_QDSS_A7SS_PC0_DBG_ROM_WORD_ADDR A:0x66000058
y.create.l HWIO_QDSS_A7SS_PC0_PM_ROM_WORD_ADDR A:0x6600005c
y.create.l HWIO_QDSS_A7SS_PC1_DBG_ROM_WORD_ADDR A:0x66000060
y.create.l HWIO_QDSS_A7SS_PC1_PM_ROM_WORD_ADDR A:0x66000064
y.create.l HWIO_QDSS_A7SS_PC2_DBG_ROM_WORD_ADDR A:0x66000068
y.create.l HWIO_QDSS_A7SS_PC2_PM_ROM_WORD_ADDR A:0x6600006c
y.create.l HWIO_QDSS_A7SS_PC3_DBG_ROM_WORD_ADDR A:0x66000070
y.create.l HWIO_QDSS_A7SS_PC3_PM_ROM_WORD_ADDR A:0x66000074
y.create.l HWIO_QDSS_A7SS_PC0_ETM_ROM_WORD_ADDR A:0x66000078
y.create.l HWIO_QDSS_A7SS_PC1_ETM_ROM_WORD_ADDR A:0x6600007c
y.create.l HWIO_QDSS_A7SS_PC2_ETM_ROM_WORD_ADDR A:0x66000080
y.create.l HWIO_QDSS_A7SS_PC3_ETM_ROM_WORD_ADDR A:0x66000084
y.create.l HWIO_QDSS_A7SS_PC0_CTI_ROM_WORD_ADDR A:0x66000088
y.create.l HWIO_QDSS_A7SS_PC1_CTI_ROM_WORD_ADDR A:0x6600008c
y.create.l HWIO_QDSS_A7SS_PC2_CTI_ROM_WORD_ADDR A:0x66000090
y.create.l HWIO_QDSS_A7SS_PC3_CTI_ROM_WORD_ADDR A:0x66000094
y.create.l HWIO_QDSS_A7SS_TFUNNEL_ROM_WORD_ADDR A:0x66000098
y.create.l HWIO_QDSS_QDSS_WRAPPER_2X1_FUNNEL_ROM_WORD_ADDR A:0x6600009c
y.create.l HWIO_QDSS_QDSS_WRAPPER_8X1_FUNNEL_ROM_WORD_ADDR A:0x660000a0
y.create.l HWIO_QDSS_HWE_EXPD_MUX_CFG_ROM_WORD_ADDR A:0x660000a4
y.create.l HWIO_QDSS_DBGUI_CFG_ROM_WORD_ADDR A:0x660000a8
y.create.l HWIO_QDSS_DAPROM_PERIPHERAL_ID4_ADDR A:0x66000fd0
y.create.l HWIO_QDSS_DAPROM_PERIPHERAL_ID5_ADDR A:0x66000fd4
y.create.l HWIO_QDSS_DAPROM_PERIPHERAL_ID6_ADDR A:0x66000fd8
y.create.l HWIO_QDSS_DAPROM_PERIPHERAL_ID7_ADDR A:0x66000fdc
y.create.l HWIO_QDSS_DAPROM_PERIPHERAL_ID0_ADDR A:0x66000fe0
y.create.l HWIO_QDSS_DAPROM_PERIPHERAL_ID1_ADDR A:0x66000fe4
y.create.l HWIO_QDSS_DAPROM_PERIPHERAL_ID2_ADDR A:0x66000fe8
y.create.l HWIO_QDSS_DAPROM_PERIPHERAL_ID3_ADDR A:0x66000fec
y.create.l HWIO_QDSS_DAPROM_COMPONENT_ID0_ADDR A:0x66000ff0
y.create.l HWIO_QDSS_DAPROM_COMPONENT_ID1_ADDR A:0x66000ff4
y.create.l HWIO_QDSS_DAPROM_COMPONENT_ID2_ADDR A:0x66000ff8
y.create.l HWIO_QDSS_DAPROM_COMPONENT_ID3_ADDR A:0x66000ffc
y.create.l HWIO_QDSS_CS_QDSSCSR_SWDBGPWRCTRL_ADDR A:0x66001000
y.create.l HWIO_QDSS_CS_QDSSCSR_SWDBGPWRACK_ADDR A:0x66001004
y.create.l HWIO_QDSS_CS_QDSSCSR_SWSPADREG0_ADDR A:0x66001008
y.create.l HWIO_QDSS_CS_QDSSCSR_SWSPADREG1_ADDR A:0x6600100c
y.create.l HWIO_QDSS_CS_QDSSCSR_STMTRANSCTRL_ADDR A:0x66001010
y.create.l HWIO_QDSS_CS_QDSSCSR_STMAWIDCTRL_ADDR A:0x66001014
y.create.l HWIO_QDSS_CS_QDSSCSR_STMCHNOFST0_ADDR A:0x66001018
y.create.l HWIO_QDSS_CS_QDSSCSR_STMCHNOFST1_ADDR A:0x6600101c
y.create.l HWIO_QDSS_CS_QDSSCSR_STMEXTHWCTRL0_ADDR A:0x66001020
y.create.l HWIO_QDSS_CS_QDSSCSR_STMEXTHWCTRL1_ADDR A:0x66001024
y.create.l HWIO_QDSS_CS_QDSSCSR_STMEXTHWCTRL2_ADDR A:0x66001028
y.create.l HWIO_QDSS_CS_QDSSCSR_STMEXTHWCTRL3_ADDR A:0x6600102c
y.create.l HWIO_QDSS_CS_QDSSCSR_USBBAMCTRL_ADDR A:0x66001030
y.create.l HWIO_QDSS_CS_QDSSCSR_USBFLSHCTRL_ADDR A:0x66001034
y.create.l HWIO_QDSS_CS_QDSSCSR_TIMESTAMPCTRL_ADDR A:0x66001038
y.create.l HWIO_QDSS_CS_QDSSCSR_AOTIMEVAL0_ADDR A:0x6600103c
y.create.l HWIO_QDSS_CS_QDSSCSR_AOTIMEVAL1_ADDR A:0x66001040
y.create.l HWIO_QDSS_CS_QDSSCSR_QDSSTIMEVAL0_ADDR A:0x66001044
y.create.l HWIO_QDSS_CS_QDSSCSR_QDSSTIMEVAL1_ADDR A:0x66001048
y.create.l HWIO_QDSS_CS_QDSSCSR_QDSSTIMELOAD0_ADDR A:0x6600104c
y.create.l HWIO_QDSS_CS_QDSSCSR_QDSSTIMELOAD1_ADDR A:0x66001050
y.create.l HWIO_QDSS_CS_QDSSCSR_DAPMSAVAL_ADDR A:0x66001054
y.create.l HWIO_QDSS_CS_QDSSCSR_QDSSCLKVOTE_ADDR A:0x66001058
y.create.l HWIO_QDSS_CS_QDSSCSR_QDSSCLKIPI_ADDR A:0x6600105c
y.create.l HWIO_QDSS_CS_QDSSCSR_QDSSPWRREQIGNORE_ADDR A:0x66001060
y.create.l HWIO_QDSS_CS_QDSSCSR_QDSSSPARE_ADDR A:0x66001064
y.create.l HWIO_QDSS_CS_QDSSCSR_IPCAT_ADDR A:0x66001068
y.create.l HWIO_QDSS_CS_QDSSCSR_ETRIRQCTRL_ADDR A:0x6600106c
y.create.l HWIO_QDSS_CS_QDSSCSR_PRESERVEETF_ADDR A:0x66001070
y.create.l HWIO_QDSS_CS_QDSSCSR_PRESERVEETR0_ADDR A:0x66001074
y.create.l HWIO_QDSS_CS_QDSSCSR_PRESERVEETR1_ADDR A:0x66001078
y.create.l HWIO_QDSS_CS_QDSSCSR_ITCTL_ADDR A:0x66001f00
y.create.l HWIO_QDSS_CS_QDSSCSR_CLAIMSET_ADDR A:0x66001fa0
y.create.l HWIO_QDSS_CS_QDSSCSR_CLAIMCLR_ADDR A:0x66001fa4
y.create.l HWIO_QDSS_CS_QDSSCSR_LOCKACCESS_ADDR A:0x66001fb0
y.create.l HWIO_QDSS_CS_QDSSCSR_LOCKSTATUS_ADDR A:0x66001fb4
y.create.l HWIO_QDSS_CS_QDSSCSR_AUTHSTATUS_ADDR A:0x66001fb8
y.create.l HWIO_QDSS_CS_QDSSCSR_DEVICEID_ADDR A:0x66001fc8
y.create.l HWIO_QDSS_CS_QDSSCSR_DEVICETYPE_ADDR A:0x66001fcc
y.create.l HWIO_QDSS_CS_QDSSCSR_PERIPHID4_ADDR A:0x66001fd0
y.create.l HWIO_QDSS_CS_QDSSCSR_PERIPHID5_ADDR A:0x66001fd4
y.create.l HWIO_QDSS_CS_QDSSCSR_PERIPHID6_ADDR A:0x66001fd8
y.create.l HWIO_QDSS_CS_QDSSCSR_PERIPHID7_ADDR A:0x66001fdc
y.create.l HWIO_QDSS_CS_QDSSCSR_PERIPHID0_ADDR A:0x66001fe0
y.create.l HWIO_QDSS_CS_QDSSCSR_PERIPHID1_ADDR A:0x66001fe4
y.create.l HWIO_QDSS_CS_QDSSCSR_PERIPHID2_ADDR A:0x66001fe8
y.create.l HWIO_QDSS_CS_QDSSCSR_PERIPHID3_ADDR A:0x66001fec
y.create.l HWIO_QDSS_CS_QDSSCSR_COMPID0_ADDR A:0x66001ff0
y.create.l HWIO_QDSS_CS_QDSSCSR_COMPID1_ADDR A:0x66001ff4
y.create.l HWIO_QDSS_CS_QDSSCSR_COMPID2_ADDR A:0x66001ff8
y.create.l HWIO_QDSS_CS_QDSSCSR_COMPID3_ADDR A:0x66001ffc
y.create.l HWIO_QDSS_STMDMASTARTR_ADDR A:0x66002c04
y.create.l HWIO_QDSS_STMDMASTOPR_ADDR A:0x66002c08
y.create.l HWIO_QDSS_STMDMASTATR_ADDR A:0x66002c0c
y.create.l HWIO_QDSS_STMDMACTLR_ADDR A:0x66002c10
y.create.l HWIO_QDSS_STMDMAIDR_ADDR A:0x66002cfc
y.create.l HWIO_QDSS_STMHEER_ADDR A:0x66002d00
y.create.l HWIO_QDSS_STMHETER_ADDR A:0x66002d20
y.create.l HWIO_QDSS_STMHEMCR_ADDR A:0x66002d64
y.create.l HWIO_QDSS_STMHEMASTR_ADDR A:0x66002df4
y.create.l HWIO_QDSS_STMHEFEAT1R_ADDR A:0x66002df8
y.create.l HWIO_QDSS_STMHEIDR_ADDR A:0x66002dfc
y.create.l HWIO_QDSS_STMSPER_ADDR A:0x66002e00
y.create.l HWIO_QDSS_STMSPTER_ADDR A:0x66002e20
y.create.l HWIO_QDSS_STMSPSCR_ADDR A:0x66002e60
y.create.l HWIO_QDSS_STMSPMSCR_ADDR A:0x66002e64
y.create.l HWIO_QDSS_STMSPOVERRIDER_ADDR A:0x66002e68
y.create.l HWIO_QDSS_STMSPMOVERRIDER_ADDR A:0x66002e6c
y.create.l HWIO_QDSS_STMSPTRIGCSR_ADDR A:0x66002e70
y.create.l HWIO_QDSS_STMTCSR_ADDR A:0x66002e80
y.create.l HWIO_QDSS_STMTSSTIMR_ADDR A:0x66002e84
y.create.l HWIO_QDSS_STMTSFREQR_ADDR A:0x66002e8c
y.create.l HWIO_QDSS_STMSYNCR_ADDR A:0x66002e90
y.create.l HWIO_QDSS_STMAUXCR_ADDR A:0x66002e94
y.create.l HWIO_QDSS_STMSPFEAT1R_ADDR A:0x66002ea0
y.create.l HWIO_QDSS_STMSPFEAT2R_ADDR A:0x66002ea4
y.create.l HWIO_QDSS_STMSPFEAT3R_ADDR A:0x66002ea8
y.create.l HWIO_QDSS_STMITTRIGGER_ADDR A:0x66002ee8
y.create.l HWIO_QDSS_STMITATBDATA0_ADDR A:0x66002eec
y.create.l HWIO_QDSS_STMITATBCTR2_ADDR A:0x66002ef0
y.create.l HWIO_QDSS_STMITATBID_ADDR A:0x66002ef4
y.create.l HWIO_QDSS_STMITATBCTR0_ADDR A:0x66002ef8
y.create.l HWIO_QDSS_STMITCTRL_ADDR A:0x66002f00
y.create.l HWIO_QDSS_STMCLAIMSET_ADDR A:0x66002fa0
y.create.l HWIO_QDSS_STMCLAIMCLR_ADDR A:0x66002fa4
y.create.l HWIO_QDSS_STMLAR_ADDR A:0x66002fb0
y.create.l HWIO_QDSS_STMLSR_ADDR A:0x66002fb4
y.create.l HWIO_QDSS_STMAUTHSTATUS_ADDR A:0x66002fb8
y.create.l HWIO_QDSS_STMDEVID_ADDR A:0x66002fc8
y.create.l HWIO_QDSS_STMDEVTYPE_ADDR A:0x66002fcc
y.create.l HWIO_QDSS_STMPIDR0_ADDR A:0x66002fe0
y.create.l HWIO_QDSS_STMPIDR1_ADDR A:0x66002fe4
y.create.l HWIO_QDSS_STMPIDR2_ADDR A:0x66002fe8
y.create.l HWIO_QDSS_STMPIDR3_ADDR A:0x66002fec
y.create.l HWIO_QDSS_STMPIDR4_ADDR A:0x66002fd0
y.create.l HWIO_QDSS_STMPIDR5_ADDR A:0x66002fd4
y.create.l HWIO_QDSS_STMPIDR6_ADDR A:0x66002fd8
y.create.l HWIO_QDSS_STMPIDR7_ADDR A:0x66002fdc
y.create.l HWIO_QDSS_STMCIDR0_ADDR A:0x66002ff0
y.create.l HWIO_QDSS_STMCIDR1_ADDR A:0x66002ff4
y.create.l HWIO_QDSS_STMCIDR2_ADDR A:0x66002ff8
y.create.l HWIO_QDSS_STMCIDR3_ADDR A:0x66002ffc
y.create.l HWIO_QDSS_CTI0_CTICONTROL_ADDR A:0x66010000
y.create.l HWIO_QDSS_CTI0_CTIINTACK_ADDR A:0x66010010
y.create.l HWIO_QDSS_CTI0_CTIAPPSET_ADDR A:0x66010014
y.create.l HWIO_QDSS_CTI0_CTIAPPCLEAR_ADDR A:0x66010018
y.create.l HWIO_QDSS_CTI0_CTIAPPPULSE_ADDR A:0x6601001c
y.create.l HWIO_QDSS_CTI0_CTIINEN0_ADDR A:0x66010020
y.create.l HWIO_QDSS_CTI0_CTIINEN1_ADDR A:0x66010024
y.create.l HWIO_QDSS_CTI0_CTIINEN2_ADDR A:0x66010028
y.create.l HWIO_QDSS_CTI0_CTIINEN3_ADDR A:0x6601002c
y.create.l HWIO_QDSS_CTI0_CTIINEN4_ADDR A:0x66010030
y.create.l HWIO_QDSS_CTI0_CTIINEN5_ADDR A:0x66010034
y.create.l HWIO_QDSS_CTI0_CTIINEN6_ADDR A:0x66010038
y.create.l HWIO_QDSS_CTI0_CTIINEN7_ADDR A:0x6601003c
y.create.l HWIO_QDSS_CTI0_CTIOUTEN0_ADDR A:0x660100a0
y.create.l HWIO_QDSS_CTI0_CTIOUTEN1_ADDR A:0x660100a4
y.create.l HWIO_QDSS_CTI0_CTIOUTEN2_ADDR A:0x660100a8
y.create.l HWIO_QDSS_CTI0_CTIOUTEN3_ADDR A:0x660100ac
y.create.l HWIO_QDSS_CTI0_CTIOUTEN4_ADDR A:0x660100b0
y.create.l HWIO_QDSS_CTI0_CTIOUTEN5_ADDR A:0x660100b4
y.create.l HWIO_QDSS_CTI0_CTIOUTEN6_ADDR A:0x660100b8
y.create.l HWIO_QDSS_CTI0_CTIOUTEN7_ADDR A:0x660100bc
y.create.l HWIO_QDSS_CTI0_CTITRIGINSTATUS_ADDR A:0x66010130
y.create.l HWIO_QDSS_CTI0_CTITRIGOUTSTATUS_ADDR A:0x66010134
y.create.l HWIO_QDSS_CTI0_CTICHINSTATUS_ADDR A:0x66010138
y.create.l HWIO_QDSS_CTI0_CTICHOUTSTATUS_ADDR A:0x6601013c
y.create.l HWIO_QDSS_CTI0_CTIGATE_ADDR A:0x66010140
y.create.l HWIO_QDSS_CTI0_ASICCTL_ADDR A:0x66010144
y.create.l HWIO_QDSS_CTI0_ITCHINACK_ADDR A:0x66010edc
y.create.l HWIO_QDSS_CTI0_ITTRIGINACK_ADDR A:0x66010ee0
y.create.l HWIO_QDSS_CTI0_ITCHOUT_ADDR A:0x66010ee4
y.create.l HWIO_QDSS_CTI0_ITTRIGOUT_ADDR A:0x66010ee8
y.create.l HWIO_QDSS_CTI0_ITCHOUTACK_ADDR A:0x66010eec
y.create.l HWIO_QDSS_CTI0_ITTRIGOUTACK_ADDR A:0x66010ef0
y.create.l HWIO_QDSS_CTI0_ITCHIN_ADDR A:0x66010ef4
y.create.l HWIO_QDSS_CTI0_ITTRIGIN_ADDR A:0x66010ef8
y.create.l HWIO_QDSS_CTI0_ITCTRL_ADDR A:0x66010f00
y.create.l HWIO_QDSS_CTI0_CLAIMSET_ADDR A:0x66010fa0
y.create.l HWIO_QDSS_CTI0_CLAIMCLR_ADDR A:0x66010fa4
y.create.l HWIO_QDSS_CTI0_LAR_ADDR A:0x66010fb0
y.create.l HWIO_QDSS_CTI0_LSR_ADDR A:0x66010fb4
y.create.l HWIO_QDSS_CTI0_AUTHSTATUS_ADDR A:0x66010fb8
y.create.l HWIO_QDSS_CTI0_DEVID_ADDR A:0x66010fc8
y.create.l HWIO_QDSS_CTI0_DEVTYPE_ADDR A:0x66010fcc
y.create.l HWIO_QDSS_CTI0_PERIPHID0_ADDR A:0x66010fe0
y.create.l HWIO_QDSS_CTI0_PERIPHID1_ADDR A:0x66010fe4
y.create.l HWIO_QDSS_CTI0_PERIPHID2_ADDR A:0x66010fe8
y.create.l HWIO_QDSS_CTI0_PERIPHID3_ADDR A:0x66010fec
y.create.l HWIO_QDSS_CTI0_PERIPHID4_ADDR A:0x66010fd0
y.create.l HWIO_QDSS_CTI0_PERIPHID5_ADDR A:0x66010fd4
y.create.l HWIO_QDSS_CTI0_PERIPHID6_ADDR A:0x66010fd8
y.create.l HWIO_QDSS_CTI0_PERIPHID7_ADDR A:0x66010fdc
y.create.l HWIO_QDSS_CTI0_COMPID0_ADDR A:0x66010ff0
y.create.l HWIO_QDSS_CTI0_COMPID1_ADDR A:0x66010ff4
y.create.l HWIO_QDSS_CTI0_COMPID2_ADDR A:0x66010ff8
y.create.l HWIO_QDSS_CTI0_COMPID3_ADDR A:0x66010ffc
y.create.l HWIO_QDSS_CTI1_CTICONTROL_ADDR A:0x66011000
y.create.l HWIO_QDSS_CTI1_CTIINTACK_ADDR A:0x66011010
y.create.l HWIO_QDSS_CTI1_CTIAPPSET_ADDR A:0x66011014
y.create.l HWIO_QDSS_CTI1_CTIAPPCLEAR_ADDR A:0x66011018
y.create.l HWIO_QDSS_CTI1_CTIAPPPULSE_ADDR A:0x6601101c
y.create.l HWIO_QDSS_CTI1_CTIINEN0_ADDR A:0x66011020
y.create.l HWIO_QDSS_CTI1_CTIINEN1_ADDR A:0x66011024
y.create.l HWIO_QDSS_CTI1_CTIINEN2_ADDR A:0x66011028
y.create.l HWIO_QDSS_CTI1_CTIINEN3_ADDR A:0x6601102c
y.create.l HWIO_QDSS_CTI1_CTIINEN4_ADDR A:0x66011030
y.create.l HWIO_QDSS_CTI1_CTIINEN5_ADDR A:0x66011034
y.create.l HWIO_QDSS_CTI1_CTIINEN6_ADDR A:0x66011038
y.create.l HWIO_QDSS_CTI1_CTIINEN7_ADDR A:0x6601103c
y.create.l HWIO_QDSS_CTI1_CTIOUTEN0_ADDR A:0x660110a0
y.create.l HWIO_QDSS_CTI1_CTIOUTEN1_ADDR A:0x660110a4
y.create.l HWIO_QDSS_CTI1_CTIOUTEN2_ADDR A:0x660110a8
y.create.l HWIO_QDSS_CTI1_CTIOUTEN3_ADDR A:0x660110ac
y.create.l HWIO_QDSS_CTI1_CTIOUTEN4_ADDR A:0x660110b0
y.create.l HWIO_QDSS_CTI1_CTIOUTEN5_ADDR A:0x660110b4
y.create.l HWIO_QDSS_CTI1_CTIOUTEN6_ADDR A:0x660110b8
y.create.l HWIO_QDSS_CTI1_CTIOUTEN7_ADDR A:0x660110bc
y.create.l HWIO_QDSS_CTI1_CTITRIGINSTATUS_ADDR A:0x66011130
y.create.l HWIO_QDSS_CTI1_CTITRIGOUTSTATUS_ADDR A:0x66011134
y.create.l HWIO_QDSS_CTI1_CTICHINSTATUS_ADDR A:0x66011138
y.create.l HWIO_QDSS_CTI1_CTICHOUTSTATUS_ADDR A:0x6601113c
y.create.l HWIO_QDSS_CTI1_CTIGATE_ADDR A:0x66011140
y.create.l HWIO_QDSS_CTI1_ASICCTL_ADDR A:0x66011144
y.create.l HWIO_QDSS_CTI1_ITCHINACK_ADDR A:0x66011edc
y.create.l HWIO_QDSS_CTI1_ITTRIGINACK_ADDR A:0x66011ee0
y.create.l HWIO_QDSS_CTI1_ITCHOUT_ADDR A:0x66011ee4
y.create.l HWIO_QDSS_CTI1_ITTRIGOUT_ADDR A:0x66011ee8
y.create.l HWIO_QDSS_CTI1_ITCHOUTACK_ADDR A:0x66011eec
y.create.l HWIO_QDSS_CTI1_ITTRIGOUTACK_ADDR A:0x66011ef0
y.create.l HWIO_QDSS_CTI1_ITCHIN_ADDR A:0x66011ef4
y.create.l HWIO_QDSS_CTI1_ITTRIGIN_ADDR A:0x66011ef8
y.create.l HWIO_QDSS_CTI1_ITCTRL_ADDR A:0x66011f00
y.create.l HWIO_QDSS_CTI1_CLAIMSET_ADDR A:0x66011fa0
y.create.l HWIO_QDSS_CTI1_CLAIMCLR_ADDR A:0x66011fa4
y.create.l HWIO_QDSS_CTI1_LAR_ADDR A:0x66011fb0
y.create.l HWIO_QDSS_CTI1_LSR_ADDR A:0x66011fb4
y.create.l HWIO_QDSS_CTI1_AUTHSTATUS_ADDR A:0x66011fb8
y.create.l HWIO_QDSS_CTI1_DEVID_ADDR A:0x66011fc8
y.create.l HWIO_QDSS_CTI1_DEVTYPE_ADDR A:0x66011fcc
y.create.l HWIO_QDSS_CTI1_PERIPHID0_ADDR A:0x66011fe0
y.create.l HWIO_QDSS_CTI1_PERIPHID1_ADDR A:0x66011fe4
y.create.l HWIO_QDSS_CTI1_PERIPHID2_ADDR A:0x66011fe8
y.create.l HWIO_QDSS_CTI1_PERIPHID3_ADDR A:0x66011fec
y.create.l HWIO_QDSS_CTI1_PERIPHID4_ADDR A:0x66011fd0
y.create.l HWIO_QDSS_CTI1_PERIPHID5_ADDR A:0x66011fd4
y.create.l HWIO_QDSS_CTI1_PERIPHID6_ADDR A:0x66011fd8
y.create.l HWIO_QDSS_CTI1_PERIPHID7_ADDR A:0x66011fdc
y.create.l HWIO_QDSS_CTI1_COMPID0_ADDR A:0x66011ff0
y.create.l HWIO_QDSS_CTI1_COMPID1_ADDR A:0x66011ff4
y.create.l HWIO_QDSS_CTI1_COMPID2_ADDR A:0x66011ff8
y.create.l HWIO_QDSS_CTI1_COMPID3_ADDR A:0x66011ffc
y.create.l HWIO_QDSS_CTI2_CTICONTROL_ADDR A:0x66012000
y.create.l HWIO_QDSS_CTI2_CTIINTACK_ADDR A:0x66012010
y.create.l HWIO_QDSS_CTI2_CTIAPPSET_ADDR A:0x66012014
y.create.l HWIO_QDSS_CTI2_CTIAPPCLEAR_ADDR A:0x66012018
y.create.l HWIO_QDSS_CTI2_CTIAPPPULSE_ADDR A:0x6601201c
y.create.l HWIO_QDSS_CTI2_CTIINEN0_ADDR A:0x66012020
y.create.l HWIO_QDSS_CTI2_CTIINEN1_ADDR A:0x66012024
y.create.l HWIO_QDSS_CTI2_CTIINEN2_ADDR A:0x66012028
y.create.l HWIO_QDSS_CTI2_CTIINEN3_ADDR A:0x6601202c
y.create.l HWIO_QDSS_CTI2_CTIINEN4_ADDR A:0x66012030
y.create.l HWIO_QDSS_CTI2_CTIINEN5_ADDR A:0x66012034
y.create.l HWIO_QDSS_CTI2_CTIINEN6_ADDR A:0x66012038
y.create.l HWIO_QDSS_CTI2_CTIINEN7_ADDR A:0x6601203c
y.create.l HWIO_QDSS_CTI2_CTIOUTEN0_ADDR A:0x660120a0
y.create.l HWIO_QDSS_CTI2_CTIOUTEN1_ADDR A:0x660120a4
y.create.l HWIO_QDSS_CTI2_CTIOUTEN2_ADDR A:0x660120a8
y.create.l HWIO_QDSS_CTI2_CTIOUTEN3_ADDR A:0x660120ac
y.create.l HWIO_QDSS_CTI2_CTIOUTEN4_ADDR A:0x660120b0
y.create.l HWIO_QDSS_CTI2_CTIOUTEN5_ADDR A:0x660120b4
y.create.l HWIO_QDSS_CTI2_CTIOUTEN6_ADDR A:0x660120b8
y.create.l HWIO_QDSS_CTI2_CTIOUTEN7_ADDR A:0x660120bc
y.create.l HWIO_QDSS_CTI2_CTITRIGINSTATUS_ADDR A:0x66012130
y.create.l HWIO_QDSS_CTI2_CTITRIGOUTSTATUS_ADDR A:0x66012134
y.create.l HWIO_QDSS_CTI2_CTICHINSTATUS_ADDR A:0x66012138
y.create.l HWIO_QDSS_CTI2_CTICHOUTSTATUS_ADDR A:0x6601213c
y.create.l HWIO_QDSS_CTI2_CTIGATE_ADDR A:0x66012140
y.create.l HWIO_QDSS_CTI2_ASICCTL_ADDR A:0x66012144
y.create.l HWIO_QDSS_CTI2_ITCHINACK_ADDR A:0x66012edc
y.create.l HWIO_QDSS_CTI2_ITTRIGINACK_ADDR A:0x66012ee0
y.create.l HWIO_QDSS_CTI2_ITCHOUT_ADDR A:0x66012ee4
y.create.l HWIO_QDSS_CTI2_ITTRIGOUT_ADDR A:0x66012ee8
y.create.l HWIO_QDSS_CTI2_ITCHOUTACK_ADDR A:0x66012eec
y.create.l HWIO_QDSS_CTI2_ITTRIGOUTACK_ADDR A:0x66012ef0
y.create.l HWIO_QDSS_CTI2_ITCHIN_ADDR A:0x66012ef4
y.create.l HWIO_QDSS_CTI2_ITTRIGIN_ADDR A:0x66012ef8
y.create.l HWIO_QDSS_CTI2_ITCTRL_ADDR A:0x66012f00
y.create.l HWIO_QDSS_CTI2_CLAIMSET_ADDR A:0x66012fa0
y.create.l HWIO_QDSS_CTI2_CLAIMCLR_ADDR A:0x66012fa4
y.create.l HWIO_QDSS_CTI2_LAR_ADDR A:0x66012fb0
y.create.l HWIO_QDSS_CTI2_LSR_ADDR A:0x66012fb4
y.create.l HWIO_QDSS_CTI2_AUTHSTATUS_ADDR A:0x66012fb8
y.create.l HWIO_QDSS_CTI2_DEVID_ADDR A:0x66012fc8
y.create.l HWIO_QDSS_CTI2_DEVTYPE_ADDR A:0x66012fcc
y.create.l HWIO_QDSS_CTI2_PERIPHID0_ADDR A:0x66012fe0
y.create.l HWIO_QDSS_CTI2_PERIPHID1_ADDR A:0x66012fe4
y.create.l HWIO_QDSS_CTI2_PERIPHID2_ADDR A:0x66012fe8
y.create.l HWIO_QDSS_CTI2_PERIPHID3_ADDR A:0x66012fec
y.create.l HWIO_QDSS_CTI2_PERIPHID4_ADDR A:0x66012fd0
y.create.l HWIO_QDSS_CTI2_PERIPHID5_ADDR A:0x66012fd4
y.create.l HWIO_QDSS_CTI2_PERIPHID6_ADDR A:0x66012fd8
y.create.l HWIO_QDSS_CTI2_PERIPHID7_ADDR A:0x66012fdc
y.create.l HWIO_QDSS_CTI2_COMPID0_ADDR A:0x66012ff0
y.create.l HWIO_QDSS_CTI2_COMPID1_ADDR A:0x66012ff4
y.create.l HWIO_QDSS_CTI2_COMPID2_ADDR A:0x66012ff8
y.create.l HWIO_QDSS_CTI2_COMPID3_ADDR A:0x66012ffc
y.create.l HWIO_QDSS_CTI3_CTICONTROL_ADDR A:0x66013000
y.create.l HWIO_QDSS_CTI3_CTIINTACK_ADDR A:0x66013010
y.create.l HWIO_QDSS_CTI3_CTIAPPSET_ADDR A:0x66013014
y.create.l HWIO_QDSS_CTI3_CTIAPPCLEAR_ADDR A:0x66013018
y.create.l HWIO_QDSS_CTI3_CTIAPPPULSE_ADDR A:0x6601301c
y.create.l HWIO_QDSS_CTI3_CTIINEN0_ADDR A:0x66013020
y.create.l HWIO_QDSS_CTI3_CTIINEN1_ADDR A:0x66013024
y.create.l HWIO_QDSS_CTI3_CTIINEN2_ADDR A:0x66013028
y.create.l HWIO_QDSS_CTI3_CTIINEN3_ADDR A:0x6601302c
y.create.l HWIO_QDSS_CTI3_CTIINEN4_ADDR A:0x66013030
y.create.l HWIO_QDSS_CTI3_CTIINEN5_ADDR A:0x66013034
y.create.l HWIO_QDSS_CTI3_CTIINEN6_ADDR A:0x66013038
y.create.l HWIO_QDSS_CTI3_CTIINEN7_ADDR A:0x6601303c
y.create.l HWIO_QDSS_CTI3_CTIOUTEN0_ADDR A:0x660130a0
y.create.l HWIO_QDSS_CTI3_CTIOUTEN1_ADDR A:0x660130a4
y.create.l HWIO_QDSS_CTI3_CTIOUTEN2_ADDR A:0x660130a8
y.create.l HWIO_QDSS_CTI3_CTIOUTEN3_ADDR A:0x660130ac
y.create.l HWIO_QDSS_CTI3_CTIOUTEN4_ADDR A:0x660130b0
y.create.l HWIO_QDSS_CTI3_CTIOUTEN5_ADDR A:0x660130b4
y.create.l HWIO_QDSS_CTI3_CTIOUTEN6_ADDR A:0x660130b8
y.create.l HWIO_QDSS_CTI3_CTIOUTEN7_ADDR A:0x660130bc
y.create.l HWIO_QDSS_CTI3_CTITRIGINSTATUS_ADDR A:0x66013130
y.create.l HWIO_QDSS_CTI3_CTITRIGOUTSTATUS_ADDR A:0x66013134
y.create.l HWIO_QDSS_CTI3_CTICHINSTATUS_ADDR A:0x66013138
y.create.l HWIO_QDSS_CTI3_CTICHOUTSTATUS_ADDR A:0x6601313c
y.create.l HWIO_QDSS_CTI3_CTIGATE_ADDR A:0x66013140
y.create.l HWIO_QDSS_CTI3_ASICCTL_ADDR A:0x66013144
y.create.l HWIO_QDSS_CTI3_ITCHINACK_ADDR A:0x66013edc
y.create.l HWIO_QDSS_CTI3_ITTRIGINACK_ADDR A:0x66013ee0
y.create.l HWIO_QDSS_CTI3_ITCHOUT_ADDR A:0x66013ee4
y.create.l HWIO_QDSS_CTI3_ITTRIGOUT_ADDR A:0x66013ee8
y.create.l HWIO_QDSS_CTI3_ITCHOUTACK_ADDR A:0x66013eec
y.create.l HWIO_QDSS_CTI3_ITTRIGOUTACK_ADDR A:0x66013ef0
y.create.l HWIO_QDSS_CTI3_ITCHIN_ADDR A:0x66013ef4
y.create.l HWIO_QDSS_CTI3_ITTRIGIN_ADDR A:0x66013ef8
y.create.l HWIO_QDSS_CTI3_ITCTRL_ADDR A:0x66013f00
y.create.l HWIO_QDSS_CTI3_CLAIMSET_ADDR A:0x66013fa0
y.create.l HWIO_QDSS_CTI3_CLAIMCLR_ADDR A:0x66013fa4
y.create.l HWIO_QDSS_CTI3_LAR_ADDR A:0x66013fb0
y.create.l HWIO_QDSS_CTI3_LSR_ADDR A:0x66013fb4
y.create.l HWIO_QDSS_CTI3_AUTHSTATUS_ADDR A:0x66013fb8
y.create.l HWIO_QDSS_CTI3_DEVID_ADDR A:0x66013fc8
y.create.l HWIO_QDSS_CTI3_DEVTYPE_ADDR A:0x66013fcc
y.create.l HWIO_QDSS_CTI3_PERIPHID0_ADDR A:0x66013fe0
y.create.l HWIO_QDSS_CTI3_PERIPHID1_ADDR A:0x66013fe4
y.create.l HWIO_QDSS_CTI3_PERIPHID2_ADDR A:0x66013fe8
y.create.l HWIO_QDSS_CTI3_PERIPHID3_ADDR A:0x66013fec
y.create.l HWIO_QDSS_CTI3_PERIPHID4_ADDR A:0x66013fd0
y.create.l HWIO_QDSS_CTI3_PERIPHID5_ADDR A:0x66013fd4
y.create.l HWIO_QDSS_CTI3_PERIPHID6_ADDR A:0x66013fd8
y.create.l HWIO_QDSS_CTI3_PERIPHID7_ADDR A:0x66013fdc
y.create.l HWIO_QDSS_CTI3_COMPID0_ADDR A:0x66013ff0
y.create.l HWIO_QDSS_CTI3_COMPID1_ADDR A:0x66013ff4
y.create.l HWIO_QDSS_CTI3_COMPID2_ADDR A:0x66013ff8
y.create.l HWIO_QDSS_CTI3_COMPID3_ADDR A:0x66013ffc
y.create.l HWIO_QDSS_CTI4_CTICONTROL_ADDR A:0x66014000
y.create.l HWIO_QDSS_CTI4_CTIINTACK_ADDR A:0x66014010
y.create.l HWIO_QDSS_CTI4_CTIAPPSET_ADDR A:0x66014014
y.create.l HWIO_QDSS_CTI4_CTIAPPCLEAR_ADDR A:0x66014018
y.create.l HWIO_QDSS_CTI4_CTIAPPPULSE_ADDR A:0x6601401c
y.create.l HWIO_QDSS_CTI4_CTIINEN0_ADDR A:0x66014020
y.create.l HWIO_QDSS_CTI4_CTIINEN1_ADDR A:0x66014024
y.create.l HWIO_QDSS_CTI4_CTIINEN2_ADDR A:0x66014028
y.create.l HWIO_QDSS_CTI4_CTIINEN3_ADDR A:0x6601402c
y.create.l HWIO_QDSS_CTI4_CTIINEN4_ADDR A:0x66014030
y.create.l HWIO_QDSS_CTI4_CTIINEN5_ADDR A:0x66014034
y.create.l HWIO_QDSS_CTI4_CTIINEN6_ADDR A:0x66014038
y.create.l HWIO_QDSS_CTI4_CTIINEN7_ADDR A:0x6601403c
y.create.l HWIO_QDSS_CTI4_CTIOUTEN0_ADDR A:0x660140a0
y.create.l HWIO_QDSS_CTI4_CTIOUTEN1_ADDR A:0x660140a4
y.create.l HWIO_QDSS_CTI4_CTIOUTEN2_ADDR A:0x660140a8
y.create.l HWIO_QDSS_CTI4_CTIOUTEN3_ADDR A:0x660140ac
y.create.l HWIO_QDSS_CTI4_CTIOUTEN4_ADDR A:0x660140b0
y.create.l HWIO_QDSS_CTI4_CTIOUTEN5_ADDR A:0x660140b4
y.create.l HWIO_QDSS_CTI4_CTIOUTEN6_ADDR A:0x660140b8
y.create.l HWIO_QDSS_CTI4_CTIOUTEN7_ADDR A:0x660140bc
y.create.l HWIO_QDSS_CTI4_CTITRIGINSTATUS_ADDR A:0x66014130
y.create.l HWIO_QDSS_CTI4_CTITRIGOUTSTATUS_ADDR A:0x66014134
y.create.l HWIO_QDSS_CTI4_CTICHINSTATUS_ADDR A:0x66014138
y.create.l HWIO_QDSS_CTI4_CTICHOUTSTATUS_ADDR A:0x6601413c
y.create.l HWIO_QDSS_CTI4_CTIGATE_ADDR A:0x66014140
y.create.l HWIO_QDSS_CTI4_ASICCTL_ADDR A:0x66014144
y.create.l HWIO_QDSS_CTI4_ITCHINACK_ADDR A:0x66014edc
y.create.l HWIO_QDSS_CTI4_ITTRIGINACK_ADDR A:0x66014ee0
y.create.l HWIO_QDSS_CTI4_ITCHOUT_ADDR A:0x66014ee4
y.create.l HWIO_QDSS_CTI4_ITTRIGOUT_ADDR A:0x66014ee8
y.create.l HWIO_QDSS_CTI4_ITCHOUTACK_ADDR A:0x66014eec
y.create.l HWIO_QDSS_CTI4_ITTRIGOUTACK_ADDR A:0x66014ef0
y.create.l HWIO_QDSS_CTI4_ITCHIN_ADDR A:0x66014ef4
y.create.l HWIO_QDSS_CTI4_ITTRIGIN_ADDR A:0x66014ef8
y.create.l HWIO_QDSS_CTI4_ITCTRL_ADDR A:0x66014f00
y.create.l HWIO_QDSS_CTI4_CLAIMSET_ADDR A:0x66014fa0
y.create.l HWIO_QDSS_CTI4_CLAIMCLR_ADDR A:0x66014fa4
y.create.l HWIO_QDSS_CTI4_LAR_ADDR A:0x66014fb0
y.create.l HWIO_QDSS_CTI4_LSR_ADDR A:0x66014fb4
y.create.l HWIO_QDSS_CTI4_AUTHSTATUS_ADDR A:0x66014fb8
y.create.l HWIO_QDSS_CTI4_DEVID_ADDR A:0x66014fc8
y.create.l HWIO_QDSS_CTI4_DEVTYPE_ADDR A:0x66014fcc
y.create.l HWIO_QDSS_CTI4_PERIPHID0_ADDR A:0x66014fe0
y.create.l HWIO_QDSS_CTI4_PERIPHID1_ADDR A:0x66014fe4
y.create.l HWIO_QDSS_CTI4_PERIPHID2_ADDR A:0x66014fe8
y.create.l HWIO_QDSS_CTI4_PERIPHID3_ADDR A:0x66014fec
y.create.l HWIO_QDSS_CTI4_PERIPHID4_ADDR A:0x66014fd0
y.create.l HWIO_QDSS_CTI4_PERIPHID5_ADDR A:0x66014fd4
y.create.l HWIO_QDSS_CTI4_PERIPHID6_ADDR A:0x66014fd8
y.create.l HWIO_QDSS_CTI4_PERIPHID7_ADDR A:0x66014fdc
y.create.l HWIO_QDSS_CTI4_COMPID0_ADDR A:0x66014ff0
y.create.l HWIO_QDSS_CTI4_COMPID1_ADDR A:0x66014ff4
y.create.l HWIO_QDSS_CTI4_COMPID2_ADDR A:0x66014ff8
y.create.l HWIO_QDSS_CTI4_COMPID3_ADDR A:0x66014ffc
y.create.l HWIO_QDSS_CTI5_CTICONTROL_ADDR A:0x66015000
y.create.l HWIO_QDSS_CTI5_CTIINTACK_ADDR A:0x66015010
y.create.l HWIO_QDSS_CTI5_CTIAPPSET_ADDR A:0x66015014
y.create.l HWIO_QDSS_CTI5_CTIAPPCLEAR_ADDR A:0x66015018
y.create.l HWIO_QDSS_CTI5_CTIAPPPULSE_ADDR A:0x6601501c
y.create.l HWIO_QDSS_CTI5_CTIINEN0_ADDR A:0x66015020
y.create.l HWIO_QDSS_CTI5_CTIINEN1_ADDR A:0x66015024
y.create.l HWIO_QDSS_CTI5_CTIINEN2_ADDR A:0x66015028
y.create.l HWIO_QDSS_CTI5_CTIINEN3_ADDR A:0x6601502c
y.create.l HWIO_QDSS_CTI5_CTIINEN4_ADDR A:0x66015030
y.create.l HWIO_QDSS_CTI5_CTIINEN5_ADDR A:0x66015034
y.create.l HWIO_QDSS_CTI5_CTIINEN6_ADDR A:0x66015038
y.create.l HWIO_QDSS_CTI5_CTIINEN7_ADDR A:0x6601503c
y.create.l HWIO_QDSS_CTI5_CTIOUTEN0_ADDR A:0x660150a0
y.create.l HWIO_QDSS_CTI5_CTIOUTEN1_ADDR A:0x660150a4
y.create.l HWIO_QDSS_CTI5_CTIOUTEN2_ADDR A:0x660150a8
y.create.l HWIO_QDSS_CTI5_CTIOUTEN3_ADDR A:0x660150ac
y.create.l HWIO_QDSS_CTI5_CTIOUTEN4_ADDR A:0x660150b0
y.create.l HWIO_QDSS_CTI5_CTIOUTEN5_ADDR A:0x660150b4
y.create.l HWIO_QDSS_CTI5_CTIOUTEN6_ADDR A:0x660150b8
y.create.l HWIO_QDSS_CTI5_CTIOUTEN7_ADDR A:0x660150bc
y.create.l HWIO_QDSS_CTI5_CTITRIGINSTATUS_ADDR A:0x66015130
y.create.l HWIO_QDSS_CTI5_CTITRIGOUTSTATUS_ADDR A:0x66015134
y.create.l HWIO_QDSS_CTI5_CTICHINSTATUS_ADDR A:0x66015138
y.create.l HWIO_QDSS_CTI5_CTICHOUTSTATUS_ADDR A:0x6601513c
y.create.l HWIO_QDSS_CTI5_CTIGATE_ADDR A:0x66015140
y.create.l HWIO_QDSS_CTI5_ASICCTL_ADDR A:0x66015144
y.create.l HWIO_QDSS_CTI5_ITCHINACK_ADDR A:0x66015edc
y.create.l HWIO_QDSS_CTI5_ITTRIGINACK_ADDR A:0x66015ee0
y.create.l HWIO_QDSS_CTI5_ITCHOUT_ADDR A:0x66015ee4
y.create.l HWIO_QDSS_CTI5_ITTRIGOUT_ADDR A:0x66015ee8
y.create.l HWIO_QDSS_CTI5_ITCHOUTACK_ADDR A:0x66015eec
y.create.l HWIO_QDSS_CTI5_ITTRIGOUTACK_ADDR A:0x66015ef0
y.create.l HWIO_QDSS_CTI5_ITCHIN_ADDR A:0x66015ef4
y.create.l HWIO_QDSS_CTI5_ITTRIGIN_ADDR A:0x66015ef8
y.create.l HWIO_QDSS_CTI5_ITCTRL_ADDR A:0x66015f00
y.create.l HWIO_QDSS_CTI5_CLAIMSET_ADDR A:0x66015fa0
y.create.l HWIO_QDSS_CTI5_CLAIMCLR_ADDR A:0x66015fa4
y.create.l HWIO_QDSS_CTI5_LAR_ADDR A:0x66015fb0
y.create.l HWIO_QDSS_CTI5_LSR_ADDR A:0x66015fb4
y.create.l HWIO_QDSS_CTI5_AUTHSTATUS_ADDR A:0x66015fb8
y.create.l HWIO_QDSS_CTI5_DEVID_ADDR A:0x66015fc8
y.create.l HWIO_QDSS_CTI5_DEVTYPE_ADDR A:0x66015fcc
y.create.l HWIO_QDSS_CTI5_PERIPHID0_ADDR A:0x66015fe0
y.create.l HWIO_QDSS_CTI5_PERIPHID1_ADDR A:0x66015fe4
y.create.l HWIO_QDSS_CTI5_PERIPHID2_ADDR A:0x66015fe8
y.create.l HWIO_QDSS_CTI5_PERIPHID3_ADDR A:0x66015fec
y.create.l HWIO_QDSS_CTI5_PERIPHID4_ADDR A:0x66015fd0
y.create.l HWIO_QDSS_CTI5_PERIPHID5_ADDR A:0x66015fd4
y.create.l HWIO_QDSS_CTI5_PERIPHID6_ADDR A:0x66015fd8
y.create.l HWIO_QDSS_CTI5_PERIPHID7_ADDR A:0x66015fdc
y.create.l HWIO_QDSS_CTI5_COMPID0_ADDR A:0x66015ff0
y.create.l HWIO_QDSS_CTI5_COMPID1_ADDR A:0x66015ff4
y.create.l HWIO_QDSS_CTI5_COMPID2_ADDR A:0x66015ff8
y.create.l HWIO_QDSS_CTI5_COMPID3_ADDR A:0x66015ffc
y.create.l HWIO_QDSS_CTI6_CTICONTROL_ADDR A:0x66016000
y.create.l HWIO_QDSS_CTI6_CTIINTACK_ADDR A:0x66016010
y.create.l HWIO_QDSS_CTI6_CTIAPPSET_ADDR A:0x66016014
y.create.l HWIO_QDSS_CTI6_CTIAPPCLEAR_ADDR A:0x66016018
y.create.l HWIO_QDSS_CTI6_CTIAPPPULSE_ADDR A:0x6601601c
y.create.l HWIO_QDSS_CTI6_CTIINEN0_ADDR A:0x66016020
y.create.l HWIO_QDSS_CTI6_CTIINEN1_ADDR A:0x66016024
y.create.l HWIO_QDSS_CTI6_CTIINEN2_ADDR A:0x66016028
y.create.l HWIO_QDSS_CTI6_CTIINEN3_ADDR A:0x6601602c
y.create.l HWIO_QDSS_CTI6_CTIINEN4_ADDR A:0x66016030
y.create.l HWIO_QDSS_CTI6_CTIINEN5_ADDR A:0x66016034
y.create.l HWIO_QDSS_CTI6_CTIINEN6_ADDR A:0x66016038
y.create.l HWIO_QDSS_CTI6_CTIINEN7_ADDR A:0x6601603c
y.create.l HWIO_QDSS_CTI6_CTIOUTEN0_ADDR A:0x660160a0
y.create.l HWIO_QDSS_CTI6_CTIOUTEN1_ADDR A:0x660160a4
y.create.l HWIO_QDSS_CTI6_CTIOUTEN2_ADDR A:0x660160a8
y.create.l HWIO_QDSS_CTI6_CTIOUTEN3_ADDR A:0x660160ac
y.create.l HWIO_QDSS_CTI6_CTIOUTEN4_ADDR A:0x660160b0
y.create.l HWIO_QDSS_CTI6_CTIOUTEN5_ADDR A:0x660160b4
y.create.l HWIO_QDSS_CTI6_CTIOUTEN6_ADDR A:0x660160b8
y.create.l HWIO_QDSS_CTI6_CTIOUTEN7_ADDR A:0x660160bc
y.create.l HWIO_QDSS_CTI6_CTITRIGINSTATUS_ADDR A:0x66016130
y.create.l HWIO_QDSS_CTI6_CTITRIGOUTSTATUS_ADDR A:0x66016134
y.create.l HWIO_QDSS_CTI6_CTICHINSTATUS_ADDR A:0x66016138
y.create.l HWIO_QDSS_CTI6_CTICHOUTSTATUS_ADDR A:0x6601613c
y.create.l HWIO_QDSS_CTI6_CTIGATE_ADDR A:0x66016140
y.create.l HWIO_QDSS_CTI6_ASICCTL_ADDR A:0x66016144
y.create.l HWIO_QDSS_CTI6_ITCHINACK_ADDR A:0x66016edc
y.create.l HWIO_QDSS_CTI6_ITTRIGINACK_ADDR A:0x66016ee0
y.create.l HWIO_QDSS_CTI6_ITCHOUT_ADDR A:0x66016ee4
y.create.l HWIO_QDSS_CTI6_ITTRIGOUT_ADDR A:0x66016ee8
y.create.l HWIO_QDSS_CTI6_ITCHOUTACK_ADDR A:0x66016eec
y.create.l HWIO_QDSS_CTI6_ITTRIGOUTACK_ADDR A:0x66016ef0
y.create.l HWIO_QDSS_CTI6_ITCHIN_ADDR A:0x66016ef4
y.create.l HWIO_QDSS_CTI6_ITTRIGIN_ADDR A:0x66016ef8
y.create.l HWIO_QDSS_CTI6_ITCTRL_ADDR A:0x66016f00
y.create.l HWIO_QDSS_CTI6_CLAIMSET_ADDR A:0x66016fa0
y.create.l HWIO_QDSS_CTI6_CLAIMCLR_ADDR A:0x66016fa4
y.create.l HWIO_QDSS_CTI6_LAR_ADDR A:0x66016fb0
y.create.l HWIO_QDSS_CTI6_LSR_ADDR A:0x66016fb4
y.create.l HWIO_QDSS_CTI6_AUTHSTATUS_ADDR A:0x66016fb8
y.create.l HWIO_QDSS_CTI6_DEVID_ADDR A:0x66016fc8
y.create.l HWIO_QDSS_CTI6_DEVTYPE_ADDR A:0x66016fcc
y.create.l HWIO_QDSS_CTI6_PERIPHID0_ADDR A:0x66016fe0
y.create.l HWIO_QDSS_CTI6_PERIPHID1_ADDR A:0x66016fe4
y.create.l HWIO_QDSS_CTI6_PERIPHID2_ADDR A:0x66016fe8
y.create.l HWIO_QDSS_CTI6_PERIPHID3_ADDR A:0x66016fec
y.create.l HWIO_QDSS_CTI6_PERIPHID4_ADDR A:0x66016fd0
y.create.l HWIO_QDSS_CTI6_PERIPHID5_ADDR A:0x66016fd4
y.create.l HWIO_QDSS_CTI6_PERIPHID6_ADDR A:0x66016fd8
y.create.l HWIO_QDSS_CTI6_PERIPHID7_ADDR A:0x66016fdc
y.create.l HWIO_QDSS_CTI6_COMPID0_ADDR A:0x66016ff0
y.create.l HWIO_QDSS_CTI6_COMPID1_ADDR A:0x66016ff4
y.create.l HWIO_QDSS_CTI6_COMPID2_ADDR A:0x66016ff8
y.create.l HWIO_QDSS_CTI6_COMPID3_ADDR A:0x66016ffc
y.create.l HWIO_QDSS_CTI7_CTICONTROL_ADDR A:0x66017000
y.create.l HWIO_QDSS_CTI7_CTIINTACK_ADDR A:0x66017010
y.create.l HWIO_QDSS_CTI7_CTIAPPSET_ADDR A:0x66017014
y.create.l HWIO_QDSS_CTI7_CTIAPPCLEAR_ADDR A:0x66017018
y.create.l HWIO_QDSS_CTI7_CTIAPPPULSE_ADDR A:0x6601701c
y.create.l HWIO_QDSS_CTI7_CTIINEN0_ADDR A:0x66017020
y.create.l HWIO_QDSS_CTI7_CTIINEN1_ADDR A:0x66017024
y.create.l HWIO_QDSS_CTI7_CTIINEN2_ADDR A:0x66017028
y.create.l HWIO_QDSS_CTI7_CTIINEN3_ADDR A:0x6601702c
y.create.l HWIO_QDSS_CTI7_CTIINEN4_ADDR A:0x66017030
y.create.l HWIO_QDSS_CTI7_CTIINEN5_ADDR A:0x66017034
y.create.l HWIO_QDSS_CTI7_CTIINEN6_ADDR A:0x66017038
y.create.l HWIO_QDSS_CTI7_CTIINEN7_ADDR A:0x6601703c
y.create.l HWIO_QDSS_CTI7_CTIOUTEN0_ADDR A:0x660170a0
y.create.l HWIO_QDSS_CTI7_CTIOUTEN1_ADDR A:0x660170a4
y.create.l HWIO_QDSS_CTI7_CTIOUTEN2_ADDR A:0x660170a8
y.create.l HWIO_QDSS_CTI7_CTIOUTEN3_ADDR A:0x660170ac
y.create.l HWIO_QDSS_CTI7_CTIOUTEN4_ADDR A:0x660170b0
y.create.l HWIO_QDSS_CTI7_CTIOUTEN5_ADDR A:0x660170b4
y.create.l HWIO_QDSS_CTI7_CTIOUTEN6_ADDR A:0x660170b8
y.create.l HWIO_QDSS_CTI7_CTIOUTEN7_ADDR A:0x660170bc
y.create.l HWIO_QDSS_CTI7_CTITRIGINSTATUS_ADDR A:0x66017130
y.create.l HWIO_QDSS_CTI7_CTITRIGOUTSTATUS_ADDR A:0x66017134
y.create.l HWIO_QDSS_CTI7_CTICHINSTATUS_ADDR A:0x66017138
y.create.l HWIO_QDSS_CTI7_CTICHOUTSTATUS_ADDR A:0x6601713c
y.create.l HWIO_QDSS_CTI7_CTIGATE_ADDR A:0x66017140
y.create.l HWIO_QDSS_CTI7_ASICCTL_ADDR A:0x66017144
y.create.l HWIO_QDSS_CTI7_ITCHINACK_ADDR A:0x66017edc
y.create.l HWIO_QDSS_CTI7_ITTRIGINACK_ADDR A:0x66017ee0
y.create.l HWIO_QDSS_CTI7_ITCHOUT_ADDR A:0x66017ee4
y.create.l HWIO_QDSS_CTI7_ITTRIGOUT_ADDR A:0x66017ee8
y.create.l HWIO_QDSS_CTI7_ITCHOUTACK_ADDR A:0x66017eec
y.create.l HWIO_QDSS_CTI7_ITTRIGOUTACK_ADDR A:0x66017ef0
y.create.l HWIO_QDSS_CTI7_ITCHIN_ADDR A:0x66017ef4
y.create.l HWIO_QDSS_CTI7_ITTRIGIN_ADDR A:0x66017ef8
y.create.l HWIO_QDSS_CTI7_ITCTRL_ADDR A:0x66017f00
y.create.l HWIO_QDSS_CTI7_CLAIMSET_ADDR A:0x66017fa0
y.create.l HWIO_QDSS_CTI7_CLAIMCLR_ADDR A:0x66017fa4
y.create.l HWIO_QDSS_CTI7_LAR_ADDR A:0x66017fb0
y.create.l HWIO_QDSS_CTI7_LSR_ADDR A:0x66017fb4
y.create.l HWIO_QDSS_CTI7_AUTHSTATUS_ADDR A:0x66017fb8
y.create.l HWIO_QDSS_CTI7_DEVID_ADDR A:0x66017fc8
y.create.l HWIO_QDSS_CTI7_DEVTYPE_ADDR A:0x66017fcc
y.create.l HWIO_QDSS_CTI7_PERIPHID0_ADDR A:0x66017fe0
y.create.l HWIO_QDSS_CTI7_PERIPHID1_ADDR A:0x66017fe4
y.create.l HWIO_QDSS_CTI7_PERIPHID2_ADDR A:0x66017fe8
y.create.l HWIO_QDSS_CTI7_PERIPHID3_ADDR A:0x66017fec
y.create.l HWIO_QDSS_CTI7_PERIPHID4_ADDR A:0x66017fd0
y.create.l HWIO_QDSS_CTI7_PERIPHID5_ADDR A:0x66017fd4
y.create.l HWIO_QDSS_CTI7_PERIPHID6_ADDR A:0x66017fd8
y.create.l HWIO_QDSS_CTI7_PERIPHID7_ADDR A:0x66017fdc
y.create.l HWIO_QDSS_CTI7_COMPID0_ADDR A:0x66017ff0
y.create.l HWIO_QDSS_CTI7_COMPID1_ADDR A:0x66017ff4
y.create.l HWIO_QDSS_CTI7_COMPID2_ADDR A:0x66017ff8
y.create.l HWIO_QDSS_CTI7_COMPID3_ADDR A:0x66017ffc
y.create.l HWIO_QDSS_CTI8_CTICONTROL_ADDR A:0x66018000
y.create.l HWIO_QDSS_CTI8_CTIINTACK_ADDR A:0x66018010
y.create.l HWIO_QDSS_CTI8_CTIAPPSET_ADDR A:0x66018014
y.create.l HWIO_QDSS_CTI8_CTIAPPCLEAR_ADDR A:0x66018018
y.create.l HWIO_QDSS_CTI8_CTIAPPPULSE_ADDR A:0x6601801c
y.create.l HWIO_QDSS_CTI8_CTIINEN0_ADDR A:0x66018020
y.create.l HWIO_QDSS_CTI8_CTIINEN1_ADDR A:0x66018024
y.create.l HWIO_QDSS_CTI8_CTIINEN2_ADDR A:0x66018028
y.create.l HWIO_QDSS_CTI8_CTIINEN3_ADDR A:0x6601802c
y.create.l HWIO_QDSS_CTI8_CTIINEN4_ADDR A:0x66018030
y.create.l HWIO_QDSS_CTI8_CTIINEN5_ADDR A:0x66018034
y.create.l HWIO_QDSS_CTI8_CTIINEN6_ADDR A:0x66018038
y.create.l HWIO_QDSS_CTI8_CTIINEN7_ADDR A:0x6601803c
y.create.l HWIO_QDSS_CTI8_CTIOUTEN0_ADDR A:0x660180a0
y.create.l HWIO_QDSS_CTI8_CTIOUTEN1_ADDR A:0x660180a4
y.create.l HWIO_QDSS_CTI8_CTIOUTEN2_ADDR A:0x660180a8
y.create.l HWIO_QDSS_CTI8_CTIOUTEN3_ADDR A:0x660180ac
y.create.l HWIO_QDSS_CTI8_CTIOUTEN4_ADDR A:0x660180b0
y.create.l HWIO_QDSS_CTI8_CTIOUTEN5_ADDR A:0x660180b4
y.create.l HWIO_QDSS_CTI8_CTIOUTEN6_ADDR A:0x660180b8
y.create.l HWIO_QDSS_CTI8_CTIOUTEN7_ADDR A:0x660180bc
y.create.l HWIO_QDSS_CTI8_CTITRIGINSTATUS_ADDR A:0x66018130
y.create.l HWIO_QDSS_CTI8_CTITRIGOUTSTATUS_ADDR A:0x66018134
y.create.l HWIO_QDSS_CTI8_CTICHINSTATUS_ADDR A:0x66018138
y.create.l HWIO_QDSS_CTI8_CTICHOUTSTATUS_ADDR A:0x6601813c
y.create.l HWIO_QDSS_CTI8_CTIGATE_ADDR A:0x66018140
y.create.l HWIO_QDSS_CTI8_ASICCTL_ADDR A:0x66018144
y.create.l HWIO_QDSS_CTI8_ITCHINACK_ADDR A:0x66018edc
y.create.l HWIO_QDSS_CTI8_ITTRIGINACK_ADDR A:0x66018ee0
y.create.l HWIO_QDSS_CTI8_ITCHOUT_ADDR A:0x66018ee4
y.create.l HWIO_QDSS_CTI8_ITTRIGOUT_ADDR A:0x66018ee8
y.create.l HWIO_QDSS_CTI8_ITCHOUTACK_ADDR A:0x66018eec
y.create.l HWIO_QDSS_CTI8_ITTRIGOUTACK_ADDR A:0x66018ef0
y.create.l HWIO_QDSS_CTI8_ITCHIN_ADDR A:0x66018ef4
y.create.l HWIO_QDSS_CTI8_ITTRIGIN_ADDR A:0x66018ef8
y.create.l HWIO_QDSS_CTI8_ITCTRL_ADDR A:0x66018f00
y.create.l HWIO_QDSS_CTI8_CLAIMSET_ADDR A:0x66018fa0
y.create.l HWIO_QDSS_CTI8_CLAIMCLR_ADDR A:0x66018fa4
y.create.l HWIO_QDSS_CTI8_LAR_ADDR A:0x66018fb0
y.create.l HWIO_QDSS_CTI8_LSR_ADDR A:0x66018fb4
y.create.l HWIO_QDSS_CTI8_AUTHSTATUS_ADDR A:0x66018fb8
y.create.l HWIO_QDSS_CTI8_DEVID_ADDR A:0x66018fc8
y.create.l HWIO_QDSS_CTI8_DEVTYPE_ADDR A:0x66018fcc
y.create.l HWIO_QDSS_CTI8_PERIPHID0_ADDR A:0x66018fe0
y.create.l HWIO_QDSS_CTI8_PERIPHID1_ADDR A:0x66018fe4
y.create.l HWIO_QDSS_CTI8_PERIPHID2_ADDR A:0x66018fe8
y.create.l HWIO_QDSS_CTI8_PERIPHID3_ADDR A:0x66018fec
y.create.l HWIO_QDSS_CTI8_PERIPHID4_ADDR A:0x66018fd0
y.create.l HWIO_QDSS_CTI8_PERIPHID5_ADDR A:0x66018fd4
y.create.l HWIO_QDSS_CTI8_PERIPHID6_ADDR A:0x66018fd8
y.create.l HWIO_QDSS_CTI8_PERIPHID7_ADDR A:0x66018fdc
y.create.l HWIO_QDSS_CTI8_COMPID0_ADDR A:0x66018ff0
y.create.l HWIO_QDSS_CTI8_COMPID1_ADDR A:0x66018ff4
y.create.l HWIO_QDSS_CTI8_COMPID2_ADDR A:0x66018ff8
y.create.l HWIO_QDSS_CTI8_COMPID3_ADDR A:0x66018ffc
y.create.l HWIO_QDSS_CSTPIU_SUPPORTED_PORT_SIZES_ADDR A:0x66020000
y.create.l HWIO_QDSS_CSTPIU_CURRENT_PORT_SIZE_ADDR A:0x66020004
y.create.l HWIO_QDSS_CSTPIU_SUPPORTED_TRIGGER_MODES_ADDR A:0x66020100
y.create.l HWIO_QDSS_CSTPIU_TRIGGER_COUNTER_VALUE_ADDR A:0x66020104
y.create.l HWIO_QDSS_CSTPIU_TRIGGER_MULTIPLIER_ADDR A:0x66020108
y.create.l HWIO_QDSS_CSTPIU_SUPPORTED_TEST_PATTERN_MODES_ADDR A:0x66020200
y.create.l HWIO_QDSS_CSTPIU_CURRENT_TEST_PATTERN_MODE_ADDR A:0x66020204
y.create.l HWIO_QDSS_CSTPIU_TPRCR_ADDR A:0x66020208
y.create.l HWIO_QDSS_CSTPIU_FFSR_ADDR A:0x66020300
y.create.l HWIO_QDSS_CSTPIU_FFCR_ADDR A:0x66020304
y.create.l HWIO_QDSS_CSTPIU_FSCR_ADDR A:0x66020308
y.create.l HWIO_QDSS_CSTPIU_EXTCTL_IN_PORT_ADDR A:0x66020400
y.create.l HWIO_QDSS_CSTPIU_EXTCTL_OUT_PORT_ADDR A:0x66020404
y.create.l HWIO_QDSS_CSTPIU_ITTRFLINACK_ADDR A:0x66020ee4
y.create.l HWIO_QDSS_CSTPIU_ITTRFLIN_ADDR A:0x66020ee8
y.create.l HWIO_QDSS_CSTPIU_ITATBDATA0_ADDR A:0x66020eec
y.create.l HWIO_QDSS_CSTPIU_ITATBCTR2_ADDR A:0x66020ef0
y.create.l HWIO_QDSS_CSTPIU_ITATBCTR1_ADDR A:0x66020ef4
y.create.l HWIO_QDSS_CSTPIU_ITATBCTR0_ADDR A:0x66020ef8
y.create.l HWIO_QDSS_CSTPIU_ITCTRL_ADDR A:0x66020f00
y.create.l HWIO_QDSS_CSTPIU_CLAIMSET_ADDR A:0x66020fa0
y.create.l HWIO_QDSS_CSTPIU_CLAIMCLR_ADDR A:0x66020fa4
y.create.l HWIO_QDSS_CSTPIU_LAR_ADDR A:0x66020fb0
y.create.l HWIO_QDSS_CSTPIU_LSR_ADDR A:0x66020fb4
y.create.l HWIO_QDSS_CSTPIU_AUTHSTATUS_ADDR A:0x66020fb8
y.create.l HWIO_QDSS_CSTPIU_DEVID_ADDR A:0x66020fc8
y.create.l HWIO_QDSS_CSTPIU_DEVTYPE_ADDR A:0x66020fcc
y.create.l HWIO_QDSS_CSTPIU_PERIPHID0_ADDR A:0x66020fe0
y.create.l HWIO_QDSS_CSTPIU_PERIPHID1_ADDR A:0x66020fe4
y.create.l HWIO_QDSS_CSTPIU_PERIPHID2_ADDR A:0x66020fe8
y.create.l HWIO_QDSS_CSTPIU_PERIPHID3_ADDR A:0x66020fec
y.create.l HWIO_QDSS_CSTPIU_PERIPHID4_ADDR A:0x66020fd0
y.create.l HWIO_QDSS_CSTPIU_PERIPHID5_ADDR A:0x66020fd4
y.create.l HWIO_QDSS_CSTPIU_PERIPHID6_ADDR A:0x66020fd8
y.create.l HWIO_QDSS_CSTPIU_PERIPHID7_ADDR A:0x66020fdc
y.create.l HWIO_QDSS_CSTPIU_COMPID0_ADDR A:0x66020ff0
y.create.l HWIO_QDSS_CSTPIU_COMPID1_ADDR A:0x66020ff4
y.create.l HWIO_QDSS_CSTPIU_COMPID2_ADDR A:0x66020ff8
y.create.l HWIO_QDSS_CSTPIU_COMPID3_ADDR A:0x66020ffc
y.create.l HWIO_QDSS_IN_FUN0_CTRL_REG_ADDR A:0x66021000
y.create.l HWIO_QDSS_IN_FUN0_PRIORITY_CTRL_REG_ADDR A:0x66021004
y.create.l HWIO_QDSS_IN_FUN0_ITATBDATA0_ADDR A:0x66021eec
y.create.l HWIO_QDSS_IN_FUN0_ITATBCTR2_ADDR A:0x66021ef0
y.create.l HWIO_QDSS_IN_FUN0_ITATBCTR1_ADDR A:0x66021ef4
y.create.l HWIO_QDSS_IN_FUN0_ITATBCTR0_ADDR A:0x66021ef8
y.create.l HWIO_QDSS_IN_FUN0_ITCTRL_ADDR A:0x66021f00
y.create.l HWIO_QDSS_IN_FUN0_CLAIMSET_ADDR A:0x66021fa0
y.create.l HWIO_QDSS_IN_FUN0_CLAIMCLR_ADDR A:0x66021fa4
y.create.l HWIO_QDSS_IN_FUN0_LOCKACCESS_ADDR A:0x66021fb0
y.create.l HWIO_QDSS_IN_FUN0_LOCKSTATUS_ADDR A:0x66021fb4
y.create.l HWIO_QDSS_IN_FUN0_AUTHSTATUS_ADDR A:0x66021fb8
y.create.l HWIO_QDSS_IN_FUN0_DEVID_ADDR A:0x66021fc8
y.create.l HWIO_QDSS_IN_FUN0_DEVTYPE_ADDR A:0x66021fcc
y.create.l HWIO_QDSS_IN_FUN0_PERIPHID0_ADDR A:0x66021fe0
y.create.l HWIO_QDSS_IN_FUN0_PERIPHID1_ADDR A:0x66021fe4
y.create.l HWIO_QDSS_IN_FUN0_PERIPHID2_ADDR A:0x66021fe8
y.create.l HWIO_QDSS_IN_FUN0_PERIPHID3_ADDR A:0x66021fec
y.create.l HWIO_QDSS_IN_FUN0_PERIPHID4_ADDR A:0x66021fd0
y.create.l HWIO_QDSS_IN_FUN0_PERIPHID5_ADDR A:0x66021fd4
y.create.l HWIO_QDSS_IN_FUN0_PERIPHID6_ADDR A:0x66021fd8
y.create.l HWIO_QDSS_IN_FUN0_PERIPHID7_ADDR A:0x66021fdc
y.create.l HWIO_QDSS_IN_FUN0_COMPID0_ADDR A:0x66021ff0
y.create.l HWIO_QDSS_IN_FUN0_COMPID1_ADDR A:0x66021ff4
y.create.l HWIO_QDSS_IN_FUN0_COMPID2_ADDR A:0x66021ff8
y.create.l HWIO_QDSS_IN_FUN0_COMPID3_ADDR A:0x66021ffc
y.create.l HWIO_QDSS_REPL64_IDFILTER0_ADDR A:0x66024000
y.create.l HWIO_QDSS_REPL64_IDFILTER1_ADDR A:0x66024004
y.create.l HWIO_QDSS_REPL64_ITATBCTR0_ADDR A:0x66024efc
y.create.l HWIO_QDSS_REPL64_ITATBCTR1_ADDR A:0x66024ef8
y.create.l HWIO_QDSS_REPL64_ITCTRL_ADDR A:0x66024f00
y.create.l HWIO_QDSS_REPL64_CLAIMSET_ADDR A:0x66024fa0
y.create.l HWIO_QDSS_REPL64_CLAIMCLR_ADDR A:0x66024fa4
y.create.l HWIO_QDSS_REPL64_LAR_ADDR A:0x66024fb0
y.create.l HWIO_QDSS_REPL64_LSR_ADDR A:0x66024fb4
y.create.l HWIO_QDSS_REPL64_AUTHSTATUS_ADDR A:0x66024fb8
y.create.l HWIO_QDSS_REPL64_DEVID_ADDR A:0x66024fc8
y.create.l HWIO_QDSS_REPL64_DEVTYPE_ADDR A:0x66024fcc
y.create.l HWIO_QDSS_REPL64_PIDR0_ADDR A:0x66024fe0
y.create.l HWIO_QDSS_REPL64_PIDR1_ADDR A:0x66024fe4
y.create.l HWIO_QDSS_REPL64_PIDR2_ADDR A:0x66024fe8
y.create.l HWIO_QDSS_REPL64_PIDR3_ADDR A:0x66024fec
y.create.l HWIO_QDSS_REPL64_PIDR4_ADDR A:0x66024fd0
y.create.l HWIO_QDSS_REPL64_PIDR5_ADDR A:0x66024fd4
y.create.l HWIO_QDSS_REPL64_PIDR6_ADDR A:0x66024fd8
y.create.l HWIO_QDSS_REPL64_PIDR7_ADDR A:0x66024fdc
y.create.l HWIO_QDSS_REPL64_CIDR0_ADDR A:0x66024ff0
y.create.l HWIO_QDSS_REPL64_CIDR1_ADDR A:0x66024ff4
y.create.l HWIO_QDSS_REPL64_CIDR2_ADDR A:0x66024ff8
y.create.l HWIO_QDSS_REPL64_CIDR3_ADDR A:0x66024ffc
y.create.l HWIO_QDSS_ETFETB_RSZ_ADDR A:0x66025004
y.create.l HWIO_QDSS_ETFETB_STS_ADDR A:0x6602500c
y.create.l HWIO_QDSS_ETFETB_RRD_ADDR A:0x66025010
y.create.l HWIO_QDSS_ETFETB_RRP_ADDR A:0x66025014
y.create.l HWIO_QDSS_ETFETB_RWP_ADDR A:0x66025018
y.create.l HWIO_QDSS_ETFETB_TRG_ADDR A:0x6602501c
y.create.l HWIO_QDSS_ETFETB_CTL_ADDR A:0x66025020
y.create.l HWIO_QDSS_ETFETB_RWD_ADDR A:0x66025024
y.create.l HWIO_QDSS_ETFETB_MODE_ADDR A:0x66025028
y.create.l HWIO_QDSS_ETFETB_LBUFLEVEL_ADDR A:0x6602502c
y.create.l HWIO_QDSS_ETFETB_CBUFLEVEL_ADDR A:0x66025030
y.create.l HWIO_QDSS_ETFETB_BUFWM_ADDR A:0x66025034
y.create.l HWIO_QDSS_ETFETB_FFSR_ADDR A:0x66025300
y.create.l HWIO_QDSS_ETFETB_FFCR_ADDR A:0x66025304
y.create.l HWIO_QDSS_ETFETB_PSCR_ADDR A:0x66025308
y.create.l HWIO_QDSS_ETFETB_ITATBMDATA0_ADDR A:0x66025ed0
y.create.l HWIO_QDSS_ETFETB_ITATBMCTR2_ADDR A:0x66025ed4
y.create.l HWIO_QDSS_ETFETB_ITATBMCTR1_ADDR A:0x66025ed8
y.create.l HWIO_QDSS_ETFETB_ITATBMCTR0_ADDR A:0x66025edc
y.create.l HWIO_QDSS_ETFETB_ITMISCOP0_ADDR A:0x66025ee0
y.create.l HWIO_QDSS_ETFETB_ITTRFLIN_ADDR A:0x66025ee8
y.create.l HWIO_QDSS_ETFETB_ITATBDATA0_ADDR A:0x66025eec
y.create.l HWIO_QDSS_ETFETB_ITATBCTR2_ADDR A:0x66025ef0
y.create.l HWIO_QDSS_ETFETB_ITATBCTR1_ADDR A:0x66025ef4
y.create.l HWIO_QDSS_ETFETB_ITATBCTR0_ADDR A:0x66025ef8
y.create.l HWIO_QDSS_ETFETB_ITCTRL_ADDR A:0x66025f00
y.create.l HWIO_QDSS_ETFETB_CLAIMSET_ADDR A:0x66025fa0
y.create.l HWIO_QDSS_ETFETB_CLAIMCLR_ADDR A:0x66025fa4
y.create.l HWIO_QDSS_ETFETB_LAR_ADDR A:0x66025fb0
y.create.l HWIO_QDSS_ETFETB_LSR_ADDR A:0x66025fb4
y.create.l HWIO_QDSS_ETFETB_AUTHSTATUS_ADDR A:0x66025fb8
y.create.l HWIO_QDSS_ETFETB_DEVID_ADDR A:0x66025fc8
y.create.l HWIO_QDSS_ETFETB_DEVTYPE_ADDR A:0x66025fcc
y.create.l HWIO_QDSS_ETFETB_PERIPHID0_ADDR A:0x66025fe0
y.create.l HWIO_QDSS_ETFETB_PERIPHID1_ADDR A:0x66025fe4
y.create.l HWIO_QDSS_ETFETB_PERIPHID2_ADDR A:0x66025fe8
y.create.l HWIO_QDSS_ETFETB_PERIPHID3_ADDR A:0x66025fec
y.create.l HWIO_QDSS_ETFETB_PERIPHID4_ADDR A:0x66025fd0
y.create.l HWIO_QDSS_ETFETB_PERIPHID5_ADDR A:0x66025fd4
y.create.l HWIO_QDSS_ETFETB_PERIPHID6_ADDR A:0x66025fd8
y.create.l HWIO_QDSS_ETFETB_PERIPHID7_ADDR A:0x66025fdc
y.create.l HWIO_QDSS_ETFETB_COMPID0_ADDR A:0x66025ff0
y.create.l HWIO_QDSS_ETFETB_COMPID1_ADDR A:0x66025ff4
y.create.l HWIO_QDSS_ETFETB_COMPID2_ADDR A:0x66025ff8
y.create.l HWIO_QDSS_ETFETB_COMPID3_ADDR A:0x66025ffc
y.create.l HWIO_QDSS_ETR_RSZ_ADDR A:0x66026004
y.create.l HWIO_QDSS_ETR_STS_ADDR A:0x6602600c
y.create.l HWIO_QDSS_ETR_RRD_ADDR A:0x66026010
y.create.l HWIO_QDSS_ETR_RRP_ADDR A:0x66026014
y.create.l HWIO_QDSS_ETR_RWP_ADDR A:0x66026018
y.create.l HWIO_QDSS_ETR_TRG_ADDR A:0x6602601c
y.create.l HWIO_QDSS_ETR_CTL_ADDR A:0x66026020
y.create.l HWIO_QDSS_ETR_RWD_ADDR A:0x66026024
y.create.l HWIO_QDSS_ETR_MODE_ADDR A:0x66026028
y.create.l HWIO_QDSS_ETR_LBUFLEVEL_ADDR A:0x6602602c
y.create.l HWIO_QDSS_ETR_CBUFLEVEL_ADDR A:0x66026030
y.create.l HWIO_QDSS_ETR_BUFWM_ADDR A:0x66026034
y.create.l HWIO_QDSS_ETR_RRPHI_ADDR A:0x66026038
y.create.l HWIO_QDSS_ETR_RWPHI_ADDR A:0x6602603c
y.create.l HWIO_QDSS_ETR_AXICTL_ADDR A:0x66026110
y.create.l HWIO_QDSS_ETR_DBALO_ADDR A:0x66026118
y.create.l HWIO_QDSS_ETR_DBAHI_ADDR A:0x6602611c
y.create.l HWIO_QDSS_ETR_FFSR_ADDR A:0x66026300
y.create.l HWIO_QDSS_ETR_FFCR_ADDR A:0x66026304
y.create.l HWIO_QDSS_ETR_PSCR_ADDR A:0x66026308
y.create.l HWIO_QDSS_ETR_ITMISCOP0_ADDR A:0x66026ee0
y.create.l HWIO_QDSS_ETR_ITTRFLIN_ADDR A:0x66026ee8
y.create.l HWIO_QDSS_ETR_ITATBDATA0_ADDR A:0x66026eec
y.create.l HWIO_QDSS_ETR_ITATBCTR2_ADDR A:0x66026ef0
y.create.l HWIO_QDSS_ETR_ITATBCTR1_ADDR A:0x66026ef4
y.create.l HWIO_QDSS_ETR_ITATBCTR0_ADDR A:0x66026ef8
y.create.l HWIO_QDSS_ETR_ITCTRL_ADDR A:0x66026f00
y.create.l HWIO_QDSS_ETR_CLAIMSET_ADDR A:0x66026fa0
y.create.l HWIO_QDSS_ETR_CLAIMCLR_ADDR A:0x66026fa4
y.create.l HWIO_QDSS_ETR_LAR_ADDR A:0x66026fb0
y.create.l HWIO_QDSS_ETR_LSR_ADDR A:0x66026fb4
y.create.l HWIO_QDSS_ETR_AUTHSTATUS_ADDR A:0x66026fb8
y.create.l HWIO_QDSS_ETR_DEVID_ADDR A:0x66026fc8
y.create.l HWIO_QDSS_ETR_DEVTYPE_ADDR A:0x66026fcc
y.create.l HWIO_QDSS_ETR_PERIPHID0_ADDR A:0x66026fe0
y.create.l HWIO_QDSS_ETR_PERIPHID1_ADDR A:0x66026fe4
y.create.l HWIO_QDSS_ETR_PERIPHID2_ADDR A:0x66026fe8
y.create.l HWIO_QDSS_ETR_PERIPHID3_ADDR A:0x66026fec
y.create.l HWIO_QDSS_ETR_PERIPHID4_ADDR A:0x66026fd0
y.create.l HWIO_QDSS_ETR_PERIPHID5_ADDR A:0x66026fd4
y.create.l HWIO_QDSS_ETR_PERIPHID6_ADDR A:0x66026fd8
y.create.l HWIO_QDSS_ETR_PERIPHID7_ADDR A:0x66026fdc
y.create.l HWIO_QDSS_ETR_COMPID0_ADDR A:0x66026ff0
y.create.l HWIO_QDSS_ETR_COMPID1_ADDR A:0x66026ff4
y.create.l HWIO_QDSS_ETR_COMPID2_ADDR A:0x66026ff8
y.create.l HWIO_QDSS_ETR_COMPID3_ADDR A:0x66026ffc
y.create.l HWIO_QDSS_NDPBAM_BAM_CTRL_ADDR A:0x66084000
y.create.l HWIO_QDSS_NDPBAM_BAM_TIMER_ADDR A:0x66084040
y.create.l HWIO_QDSS_NDPBAM_BAM_TIMER_CTRL_ADDR A:0x66084044
y.create.l HWIO_QDSS_NDPBAM_BAM_DESC_CNT_TRSHLD_ADDR A:0x66084008
y.create.l HWIO_QDSS_NDPBAM_BAM_IRQ_STTS_ADDR A:0x66084014
y.create.l HWIO_QDSS_NDPBAM_BAM_IRQ_CLR_ADDR A:0x66084018
y.create.l HWIO_QDSS_NDPBAM_BAM_IRQ_EN_ADDR A:0x6608401c
y.create.l HWIO_QDSS_NDPBAM_BAM_CNFG_BITS_ADDR A:0x6608407c
y.create.l HWIO_QDSS_NDPBAM_BAM_CNFG_BITS_2_ADDR A:0x66084084
y.create.l HWIO_QDSS_NDPBAM_BAM_REVISION_ADDR A:0x66085000
y.create.l HWIO_QDSS_NDPBAM_BAM_SW_VERSION_ADDR A:0x66085004
y.create.l HWIO_QDSS_NDPBAM_BAM_NUM_PIPES_ADDR A:0x66085008
y.create.l HWIO_QDSS_NDPBAM_BAM_TEST_BUS_SEL_ADDR A:0x66085010
y.create.l HWIO_QDSS_NDPBAM_BAM_TEST_BUS_REG_ADDR A:0x66085014
y.create.l HWIO_QDSS_NDPBAM_BAM_AHB_MASTER_ERR_CTRLS_ADDR A:0x66085024
y.create.l HWIO_QDSS_NDPBAM_BAM_AHB_MASTER_ERR_ADDR_ADDR A:0x66085028
y.create.l HWIO_QDSS_NDPBAM_BAM_AHB_MASTER_ERR_DATA_ADDR A:0x6608502c
y.create.l HWIO_QDSS_NDPBAM_BAM_AHB_MASTER_ERR_ADDR_LSB_ADDR A:0x66085100
y.create.l HWIO_QDSS_NDPBAM_BAM_AHB_MASTER_ERR_ADDR_MSB_ADDR A:0x66085104
y.create.l HWIO_QDSS_NDPBAM_BAM_TRUST_REG_ADDR A:0x66086000
y.create.l HWIO_QDSS_NDPBAM_BAM_P_TRUST_REG0_ADDR A:0x66086020
y.create.l HWIO_QDSS_NDPBAM_BAM_P_TRUST_REG1_ADDR A:0x66086024
y.create.l HWIO_QDSS_NDPBAM_BAM_IRQ_SRCS_EE0_ADDR A:0x66087000
y.create.l HWIO_QDSS_NDPBAM_BAM_IRQ_SRCS_EE1_ADDR A:0x66088000
y.create.l HWIO_QDSS_NDPBAM_BAM_IRQ_SRCS_EE2_ADDR A:0x66089000
y.create.l HWIO_QDSS_NDPBAM_BAM_IRQ_SRCS_EE3_ADDR A:0x6608a000
y.create.l HWIO_QDSS_NDPBAM_BAM_IRQ_SRCS_EE4_ADDR A:0x6608b000
y.create.l HWIO_QDSS_NDPBAM_BAM_IRQ_SRCS_EE5_ADDR A:0x6608c000
y.create.l HWIO_QDSS_NDPBAM_BAM_IRQ_SRCS_EE6_ADDR A:0x6608d000
y.create.l HWIO_QDSS_NDPBAM_BAM_IRQ_SRCS_EE7_ADDR A:0x6608e000
y.create.l HWIO_QDSS_NDPBAM_BAM_IRQ_SRCS_MSK_EE0_ADDR A:0x66087004
y.create.l HWIO_QDSS_NDPBAM_BAM_IRQ_SRCS_MSK_EE1_ADDR A:0x66088004
y.create.l HWIO_QDSS_NDPBAM_BAM_IRQ_SRCS_MSK_EE2_ADDR A:0x66089004
y.create.l HWIO_QDSS_NDPBAM_BAM_IRQ_SRCS_MSK_EE3_ADDR A:0x6608a004
y.create.l HWIO_QDSS_NDPBAM_BAM_IRQ_SRCS_MSK_EE4_ADDR A:0x6608b004
y.create.l HWIO_QDSS_NDPBAM_BAM_IRQ_SRCS_MSK_EE5_ADDR A:0x6608c004
y.create.l HWIO_QDSS_NDPBAM_BAM_IRQ_SRCS_MSK_EE6_ADDR A:0x6608d004
y.create.l HWIO_QDSS_NDPBAM_BAM_IRQ_SRCS_MSK_EE7_ADDR A:0x6608e004
y.create.l HWIO_QDSS_NDPBAM_BAM_IRQ_SRCS_UNMASKED_EE0_ADDR A:0x66087008
y.create.l HWIO_QDSS_NDPBAM_BAM_IRQ_SRCS_UNMASKED_EE1_ADDR A:0x66088008
y.create.l HWIO_QDSS_NDPBAM_BAM_IRQ_SRCS_UNMASKED_EE2_ADDR A:0x66089008
y.create.l HWIO_QDSS_NDPBAM_BAM_IRQ_SRCS_UNMASKED_EE3_ADDR A:0x6608a008
y.create.l HWIO_QDSS_NDPBAM_BAM_IRQ_SRCS_UNMASKED_EE4_ADDR A:0x6608b008
y.create.l HWIO_QDSS_NDPBAM_BAM_IRQ_SRCS_UNMASKED_EE5_ADDR A:0x6608c008
y.create.l HWIO_QDSS_NDPBAM_BAM_IRQ_SRCS_UNMASKED_EE6_ADDR A:0x6608d008
y.create.l HWIO_QDSS_NDPBAM_BAM_IRQ_SRCS_UNMASKED_EE7_ADDR A:0x6608e008
y.create.l HWIO_QDSS_NDPBAM_BAM_PIPE_ATTR_EE0_ADDR A:0x6608700c
y.create.l HWIO_QDSS_NDPBAM_BAM_PIPE_ATTR_EE1_ADDR A:0x6608800c
y.create.l HWIO_QDSS_NDPBAM_BAM_PIPE_ATTR_EE2_ADDR A:0x6608900c
y.create.l HWIO_QDSS_NDPBAM_BAM_PIPE_ATTR_EE3_ADDR A:0x6608a00c
y.create.l HWIO_QDSS_NDPBAM_BAM_PIPE_ATTR_EE4_ADDR A:0x6608b00c
y.create.l HWIO_QDSS_NDPBAM_BAM_PIPE_ATTR_EE5_ADDR A:0x6608c00c
y.create.l HWIO_QDSS_NDPBAM_BAM_PIPE_ATTR_EE6_ADDR A:0x6608d00c
y.create.l HWIO_QDSS_NDPBAM_BAM_PIPE_ATTR_EE7_ADDR A:0x6608e00c
y.create.l HWIO_QDSS_NDPBAM_BAM_IRQ_SRCS_ADDR A:0x66087010
y.create.l HWIO_QDSS_NDPBAM_BAM_IRQ_SRCS_MSK_ADDR A:0x66087014
y.create.l HWIO_QDSS_NDPBAM_BAM_IRQ_SRCS_UNMASKED_ADDR A:0x66087018
y.create.l HWIO_QDSS_NDPBAM_BAM_P_CTRL0_ADDR A:0x66097000
y.create.l HWIO_QDSS_NDPBAM_BAM_P_CTRL1_ADDR A:0x66098000
y.create.l HWIO_QDSS_NDPBAM_BAM_P_RST0_ADDR A:0x66097004
y.create.l HWIO_QDSS_NDPBAM_BAM_P_RST1_ADDR A:0x66098004
y.create.l HWIO_QDSS_NDPBAM_BAM_P_HALT0_ADDR A:0x66097008
y.create.l HWIO_QDSS_NDPBAM_BAM_P_HALT1_ADDR A:0x66098008
y.create.l HWIO_QDSS_NDPBAM_BAM_P_IRQ_STTS0_ADDR A:0x66097010
y.create.l HWIO_QDSS_NDPBAM_BAM_P_IRQ_STTS1_ADDR A:0x66098010
y.create.l HWIO_QDSS_NDPBAM_BAM_P_IRQ_CLR0_ADDR A:0x66097014
y.create.l HWIO_QDSS_NDPBAM_BAM_P_IRQ_CLR1_ADDR A:0x66098014
y.create.l HWIO_QDSS_NDPBAM_BAM_P_IRQ_EN0_ADDR A:0x66097018
y.create.l HWIO_QDSS_NDPBAM_BAM_P_IRQ_EN1_ADDR A:0x66098018
y.create.l HWIO_QDSS_NDPBAM_BAM_P_TIMER0_ADDR A:0x6609701c
y.create.l HWIO_QDSS_NDPBAM_BAM_P_TIMER1_ADDR A:0x6609801c
y.create.l HWIO_QDSS_NDPBAM_BAM_P_TIMER_CTRL0_ADDR A:0x66097020
y.create.l HWIO_QDSS_NDPBAM_BAM_P_TIMER_CTRL1_ADDR A:0x66098020
y.create.l HWIO_QDSS_NDPBAM_BAM_P_PRDCR_SDBND0_ADDR A:0x66097024
y.create.l HWIO_QDSS_NDPBAM_BAM_P_PRDCR_SDBND1_ADDR A:0x66098024
y.create.l HWIO_QDSS_NDPBAM_BAM_P_CNSMR_SDBND0_ADDR A:0x66097028
y.create.l HWIO_QDSS_NDPBAM_BAM_P_CNSMR_SDBND1_ADDR A:0x66098028
y.create.l HWIO_QDSS_NDPBAM_BAM_P_SW_OFSTS0_ADDR A:0x66097800
y.create.l HWIO_QDSS_NDPBAM_BAM_P_SW_OFSTS1_ADDR A:0x66098800
y.create.l HWIO_QDSS_NDPBAM_BAM_P_AU_PSM_CNTXT_1_0_ADDR A:0x66097804
y.create.l HWIO_QDSS_NDPBAM_BAM_P_AU_PSM_CNTXT_1_1_ADDR A:0x66098804
y.create.l HWIO_QDSS_NDPBAM_BAM_P_PSM_CNTXT_2_0_ADDR A:0x66097808
y.create.l HWIO_QDSS_NDPBAM_BAM_P_PSM_CNTXT_2_1_ADDR A:0x66098808
y.create.l HWIO_QDSS_NDPBAM_BAM_P_PSM_CNTXT_3_0_ADDR A:0x6609780c
y.create.l HWIO_QDSS_NDPBAM_BAM_P_PSM_CNTXT_3_1_ADDR A:0x6609880c
y.create.l HWIO_QDSS_NDPBAM_BAM_P_PSM_CNTXT_4_0_ADDR A:0x66097810
y.create.l HWIO_QDSS_NDPBAM_BAM_P_PSM_CNTXT_4_1_ADDR A:0x66098810
y.create.l HWIO_QDSS_NDPBAM_BAM_P_PSM_CNTXT_5_0_ADDR A:0x66097814
y.create.l HWIO_QDSS_NDPBAM_BAM_P_PSM_CNTXT_5_1_ADDR A:0x66098814
y.create.l HWIO_QDSS_NDPBAM_BAM_P_EVNT_REG0_ADDR A:0x66097818
y.create.l HWIO_QDSS_NDPBAM_BAM_P_EVNT_REG1_ADDR A:0x66098818
y.create.l HWIO_QDSS_NDPBAM_BAM_P_DESC_FIFO_ADDR0_ADDR A:0x6609781c
y.create.l HWIO_QDSS_NDPBAM_BAM_P_DESC_FIFO_ADDR1_ADDR A:0x6609881c
y.create.l HWIO_QDSS_NDPBAM_BAM_P_FIFO_SIZES0_ADDR A:0x66097820
y.create.l HWIO_QDSS_NDPBAM_BAM_P_FIFO_SIZES1_ADDR A:0x66098820
y.create.l HWIO_QDSS_NDPBAM_BAM_P_DATA_FIFO_ADDR0_ADDR A:0x66097824
y.create.l HWIO_QDSS_NDPBAM_BAM_P_DATA_FIFO_ADDR1_ADDR A:0x66098824
y.create.l HWIO_QDSS_NDPBAM_BAM_P_EVNT_GEN_TRSHLD0_ADDR A:0x66097828
y.create.l HWIO_QDSS_NDPBAM_BAM_P_EVNT_GEN_TRSHLD1_ADDR A:0x66098828
y.create.l HWIO_QDSS_NDPBAM_BAM_P_EVNT_DEST_ADDR0_ADDR A:0x6609782c
y.create.l HWIO_QDSS_NDPBAM_BAM_P_EVNT_DEST_ADDR1_ADDR A:0x6609882c
y.create.l HWIO_QDSS_NDPBAM_BAM_P_DF_CNTXT_0_ADDR A:0x66097830
y.create.l HWIO_QDSS_NDPBAM_BAM_P_DF_CNTXT_1_ADDR A:0x66098830
y.create.l HWIO_QDSS_NDPBAM_BAM_P_RETR_CNTXT_0_ADDR A:0x66097834
y.create.l HWIO_QDSS_NDPBAM_BAM_P_RETR_CNTXT_1_ADDR A:0x66098834
y.create.l HWIO_QDSS_NDPBAM_BAM_P_SI_CNTXT_0_ADDR A:0x66097838
y.create.l HWIO_QDSS_NDPBAM_BAM_P_SI_CNTXT_1_ADDR A:0x66098838
y.create.l HWIO_QDSS_NDPBAM_BAM_P_PSM_CNTXT_3_LSB0_ADDR A:0x66097900
y.create.l HWIO_QDSS_NDPBAM_BAM_P_PSM_CNTXT_3_LSB1_ADDR A:0x66098900
y.create.l HWIO_QDSS_NDPBAM_BAM_P_PSM_CNTXT_3_MSB0_ADDR A:0x66097904
y.create.l HWIO_QDSS_NDPBAM_BAM_P_PSM_CNTXT_3_MSB1_ADDR A:0x66098904
y.create.l HWIO_QDSS_NDPBAM_BAM_P_DESC_FIFO_ADDR_LSB0_ADDR A:0x66097910
y.create.l HWIO_QDSS_NDPBAM_BAM_P_DESC_FIFO_ADDR_LSB1_ADDR A:0x66098910
y.create.l HWIO_QDSS_NDPBAM_BAM_P_DESC_FIFO_ADDR_MSB0_ADDR A:0x66097914
y.create.l HWIO_QDSS_NDPBAM_BAM_P_DESC_FIFO_ADDR_MSB1_ADDR A:0x66098914
y.create.l HWIO_QDSS_NDPBAM_BAM_P_DATA_FIFO_ADDR_LSB0_ADDR A:0x66097920
y.create.l HWIO_QDSS_NDPBAM_BAM_P_DATA_FIFO_ADDR_LSB1_ADDR A:0x66098920
y.create.l HWIO_QDSS_NDPBAM_BAM_P_DATA_FIFO_ADDR_MSB0_ADDR A:0x66097924
y.create.l HWIO_QDSS_NDPBAM_BAM_P_DATA_FIFO_ADDR_MSB1_ADDR A:0x66098924
y.create.l HWIO_QDSS_NDPBAM_BAM_P_EVNT_DEST_ADDR_LSB0_ADDR A:0x66097930
y.create.l HWIO_QDSS_NDPBAM_BAM_P_EVNT_DEST_ADDR_LSB1_ADDR A:0x66098930
y.create.l HWIO_QDSS_NDPBAM_BAM_P_EVNT_DEST_ADDR_MSB0_ADDR A:0x66097934
y.create.l HWIO_QDSS_NDPBAM_BAM_P_EVNT_DEST_ADDR_MSB1_ADDR A:0x66098934
y.create.l HWIO_QDSS_WRAPPER_ATB_FUN2X1_CTRL_REG_ADDR A:0x66068000
y.create.l HWIO_QDSS_WRAPPER_ATB_FUN2X1_PRIORITY_CTRL_REG_ADDR A:0x66068004
y.create.l HWIO_QDSS_WRAPPER_ATB_FUN2X1_ITATBDATA0_ADDR A:0x66068eec
y.create.l HWIO_QDSS_WRAPPER_ATB_FUN2X1_ITATBCTR2_ADDR A:0x66068ef0
y.create.l HWIO_QDSS_WRAPPER_ATB_FUN2X1_ITATBCTR1_ADDR A:0x66068ef4
y.create.l HWIO_QDSS_WRAPPER_ATB_FUN2X1_ITATBCTR0_ADDR A:0x66068ef8
y.create.l HWIO_QDSS_WRAPPER_ATB_FUN2X1_ITCTRL_ADDR A:0x66068f00
y.create.l HWIO_QDSS_WRAPPER_ATB_FUN2X1_CLAIMSET_ADDR A:0x66068fa0
y.create.l HWIO_QDSS_WRAPPER_ATB_FUN2X1_CLAIMCLR_ADDR A:0x66068fa4
y.create.l HWIO_QDSS_WRAPPER_ATB_FUN2X1_LOCKACCESS_ADDR A:0x66068fb0
y.create.l HWIO_QDSS_WRAPPER_ATB_FUN2X1_LOCKSTATUS_ADDR A:0x66068fb4
y.create.l HWIO_QDSS_WRAPPER_ATB_FUN2X1_AUTHSTATUS_ADDR A:0x66068fb8
y.create.l HWIO_QDSS_WRAPPER_ATB_FUN2X1_DEVID_ADDR A:0x66068fc8
y.create.l HWIO_QDSS_WRAPPER_ATB_FUN2X1_DEVTYPE_ADDR A:0x66068fcc
y.create.l HWIO_QDSS_WRAPPER_ATB_FUN2X1_PERIPHID0_ADDR A:0x66068fe0
y.create.l HWIO_QDSS_WRAPPER_ATB_FUN2X1_PERIPHID1_ADDR A:0x66068fe4
y.create.l HWIO_QDSS_WRAPPER_ATB_FUN2X1_PERIPHID2_ADDR A:0x66068fe8
y.create.l HWIO_QDSS_WRAPPER_ATB_FUN2X1_PERIPHID3_ADDR A:0x66068fec
y.create.l HWIO_QDSS_WRAPPER_ATB_FUN2X1_PERIPHID4_ADDR A:0x66068fd0
y.create.l HWIO_QDSS_WRAPPER_ATB_FUN2X1_PERIPHID5_ADDR A:0x66068fd4
y.create.l HWIO_QDSS_WRAPPER_ATB_FUN2X1_PERIPHID6_ADDR A:0x66068fd8
y.create.l HWIO_QDSS_WRAPPER_ATB_FUN2X1_PERIPHID7_ADDR A:0x66068fdc
y.create.l HWIO_QDSS_WRAPPER_ATB_FUN2X1_COMPID0_ADDR A:0x66068ff0
y.create.l HWIO_QDSS_WRAPPER_ATB_FUN2X1_COMPID1_ADDR A:0x66068ff4
y.create.l HWIO_QDSS_WRAPPER_ATB_FUN2X1_COMPID2_ADDR A:0x66068ff8
y.create.l HWIO_QDSS_WRAPPER_ATB_FUN2X1_COMPID3_ADDR A:0x66068ffc
y.create.l HWIO_QDSS_WRAPPER_HWEVENT_EXPD_COL0_OEN_REG_ADDR A:0x6606c000
y.create.l HWIO_QDSS_WRAPPER_HWEVENT_EXPD_COL1_OEN_REG_ADDR A:0x6606c004
y.create.l HWIO_QDSS_WRAPPER_HWEVENT_EXPD_COL2_OEN_REG_ADDR A:0x6606c008
y.create.l HWIO_QDSS_WRAPPER_HWEVENT_EXPD_COL3_OEN_REG_ADDR A:0x6606c00c
y.create.l HWIO_QDSS_WRAPPER_HWEVENT_EXPD_COL4_OEN_REG_ADDR A:0x6606c010
y.create.l HWIO_QDSS_WRAPPER_HWEVENT_EXPD_COL5_OEN_REG_ADDR A:0x6606c014
y.create.l HWIO_QDSS_WRAPPER_HWEVENT_EXPD_COL6_OEN_REG_ADDR A:0x6606c018
y.create.l HWIO_QDSS_WRAPPER_HWEVENT_EXPD_COL7_OEN_REG_ADDR A:0x6606c01c
y.create.l HWIO_QDSS_WRAPPER_HWEVENT_EXPD_COL8_OEN_REG_ADDR A:0x6606c020
y.create.l HWIO_QDSS_WRAPPER_HWEVENT_EXPD_COL9_OEN_REG_ADDR A:0x6606c024
y.create.l HWIO_QDSS_WRAPPER_HWEVENT_EXPD_COL0_MUX_SEL0_REG_ADDR A:0x6606c040
y.create.l HWIO_QDSS_WRAPPER_HWEVENT_EXPD_COL1_MUX_SEL0_REG_ADDR A:0x6606c050
y.create.l HWIO_QDSS_WRAPPER_HWEVENT_EXPD_COL2_MUX_SEL0_REG_ADDR A:0x6606c060
y.create.l HWIO_QDSS_WRAPPER_HWEVENT_EXPD_COL3_MUX_SEL0_REG_ADDR A:0x6606c070
y.create.l HWIO_QDSS_WRAPPER_HWEVENT_EXPD_COL4_MUX_SEL0_REG_ADDR A:0x6606c080
y.create.l HWIO_QDSS_WRAPPER_HWEVENT_EXPD_COL5_MUX_SEL0_REG_ADDR A:0x6606c090
y.create.l HWIO_QDSS_WRAPPER_HWEVENT_EXPD_COL6_MUX_SEL0_REG_ADDR A:0x6606c0a0
y.create.l HWIO_QDSS_WRAPPER_HWEVENT_EXPD_COL7_MUX_SEL0_REG_ADDR A:0x6606c0b0
y.create.l HWIO_QDSS_WRAPPER_HWEVENT_EXPD_COL8_MUX_SEL0_REG_ADDR A:0x6606c0c0
y.create.l HWIO_QDSS_WRAPPER_HWEVENT_EXPD_COL9_MUX_SEL0_REG_ADDR A:0x6606c0d0
y.create.l HWIO_QDSS_WRAPPER_HWEVENT_EXPD_COL0_MUX_SEL1_REG_ADDR A:0x6606c044
y.create.l HWIO_QDSS_WRAPPER_HWEVENT_EXPD_COL1_MUX_SEL1_REG_ADDR A:0x6606c054
y.create.l HWIO_QDSS_WRAPPER_HWEVENT_EXPD_COL2_MUX_SEL1_REG_ADDR A:0x6606c064
y.create.l HWIO_QDSS_WRAPPER_HWEVENT_EXPD_COL3_MUX_SEL1_REG_ADDR A:0x6606c074
y.create.l HWIO_QDSS_WRAPPER_HWEVENT_EXPD_COL4_MUX_SEL1_REG_ADDR A:0x6606c084
y.create.l HWIO_QDSS_WRAPPER_HWEVENT_EXPD_COL5_MUX_SEL1_REG_ADDR A:0x6606c094
y.create.l HWIO_QDSS_WRAPPER_HWEVENT_EXPD_COL6_MUX_SEL1_REG_ADDR A:0x6606c0a4
y.create.l HWIO_QDSS_WRAPPER_HWEVENT_EXPD_COL7_MUX_SEL1_REG_ADDR A:0x6606c0b4
y.create.l HWIO_QDSS_WRAPPER_HWEVENT_EXPD_COL8_MUX_SEL1_REG_ADDR A:0x6606c0c4
y.create.l HWIO_QDSS_WRAPPER_HWEVENT_EXPD_COL9_MUX_SEL1_REG_ADDR A:0x6606c0d4
y.create.l HWIO_QDSS_WRAPPER_HWEVENT_EXPD_COL0_MUX_SEL2_REG_ADDR A:0x6606c048
y.create.l HWIO_QDSS_WRAPPER_HWEVENT_EXPD_COL1_MUX_SEL2_REG_ADDR A:0x6606c058
y.create.l HWIO_QDSS_WRAPPER_HWEVENT_EXPD_COL2_MUX_SEL2_REG_ADDR A:0x6606c068
y.create.l HWIO_QDSS_WRAPPER_HWEVENT_EXPD_COL3_MUX_SEL2_REG_ADDR A:0x6606c078
y.create.l HWIO_QDSS_WRAPPER_HWEVENT_EXPD_COL4_MUX_SEL2_REG_ADDR A:0x6606c088
y.create.l HWIO_QDSS_WRAPPER_HWEVENT_EXPD_COL5_MUX_SEL2_REG_ADDR A:0x6606c098
y.create.l HWIO_QDSS_WRAPPER_HWEVENT_EXPD_COL6_MUX_SEL2_REG_ADDR A:0x6606c0a8
y.create.l HWIO_QDSS_WRAPPER_HWEVENT_EXPD_COL7_MUX_SEL2_REG_ADDR A:0x6606c0b8
y.create.l HWIO_QDSS_WRAPPER_HWEVENT_EXPD_COL8_MUX_SEL2_REG_ADDR A:0x6606c0c8
y.create.l HWIO_QDSS_WRAPPER_HWEVENT_EXPD_COL9_MUX_SEL2_REG_ADDR A:0x6606c0d8
y.create.l HWIO_QDSS_WRAPPER_HWEVENT_EXPD_COL0_MUX_SEL3_REG_ADDR A:0x6606c04c
y.create.l HWIO_QDSS_WRAPPER_HWEVENT_EXPD_COL1_MUX_SEL3_REG_ADDR A:0x6606c05c
y.create.l HWIO_QDSS_WRAPPER_HWEVENT_EXPD_COL2_MUX_SEL3_REG_ADDR A:0x6606c06c
y.create.l HWIO_QDSS_WRAPPER_HWEVENT_EXPD_COL3_MUX_SEL3_REG_ADDR A:0x6606c07c
y.create.l HWIO_QDSS_WRAPPER_HWEVENT_EXPD_COL4_MUX_SEL3_REG_ADDR A:0x6606c08c
y.create.l HWIO_QDSS_WRAPPER_HWEVENT_EXPD_COL5_MUX_SEL3_REG_ADDR A:0x6606c09c
y.create.l HWIO_QDSS_WRAPPER_HWEVENT_EXPD_COL6_MUX_SEL3_REG_ADDR A:0x6606c0ac
y.create.l HWIO_QDSS_WRAPPER_HWEVENT_EXPD_COL7_MUX_SEL3_REG_ADDR A:0x6606c0bc
y.create.l HWIO_QDSS_WRAPPER_HWEVENT_EXPD_COL8_MUX_SEL3_REG_ADDR A:0x6606c0cc
y.create.l HWIO_QDSS_WRAPPER_HWEVENT_EXPD_COL9_MUX_SEL3_REG_ADDR A:0x6606c0dc
y.create.l HWIO_QDSS_WRAPPER_IRQ_MUX_REG_ADDR A:0x6606c140
y.create.l HWIO_QDSS_WRAPPER_HWE_SPDM_MUX_REG_ADDR A:0x6606c144
y.create.l HWIO_QDSS_WRAPPER_CS_HWE_EXPD_ITCTL_ADDR A:0x6606cf00
y.create.l HWIO_QDSS_WRAPPER_CS_HWE_EXPD_CLAIMSET_ADDR A:0x6606cfa0
y.create.l HWIO_QDSS_WRAPPER_CS_HWE_EXPD_CLAIMCLR_ADDR A:0x6606cfa4
y.create.l HWIO_QDSS_WRAPPER_CS_HWE_EXPD_LOCKACCESS_ADDR A:0x6606cfb0
y.create.l HWIO_QDSS_WRAPPER_CS_HWE_EXPD_LOCKSTATUS_ADDR A:0x6606cfb4
y.create.l HWIO_QDSS_WRAPPER_CS_HWE_EXPD_AUTHSTATUS_ADDR A:0x6606cfb8
y.create.l HWIO_QDSS_WRAPPER_CS_HWE_EXPD_DEVICEID_ADDR A:0x6606cfc8
y.create.l HWIO_QDSS_WRAPPER_CS_HWE_EXPD_DEVICETYPE_ADDR A:0x6606cfcc
y.create.l HWIO_QDSS_WRAPPER_CS_HWE_EXPD_PERIPHID4_ADDR A:0x6606cfd0
y.create.l HWIO_QDSS_WRAPPER_CS_HWE_EXPD_PERIPHID5_ADDR A:0x6606cfd4
y.create.l HWIO_QDSS_WRAPPER_CS_HWE_EXPD_PERIPHID6_ADDR A:0x6606cfd8
y.create.l HWIO_QDSS_WRAPPER_CS_HWE_EXPD_PERIPHID7_ADDR A:0x6606cfdc
y.create.l HWIO_QDSS_WRAPPER_CS_HWE_EXPD_PERIPHID0_ADDR A:0x6606cfe0
y.create.l HWIO_QDSS_WRAPPER_CS_HWE_EXPD_PERIPHID1_ADDR A:0x6606cfe4
y.create.l HWIO_QDSS_WRAPPER_CS_HWE_EXPD_PERIPHID2_ADDR A:0x6606cfe8
y.create.l HWIO_QDSS_WRAPPER_CS_HWE_EXPD_PERIPHID3_ADDR A:0x6606cfec
y.create.l HWIO_QDSS_WRAPPER_CS_HWE_EXPD_COMPID0_ADDR A:0x6606cff0
y.create.l HWIO_QDSS_WRAPPER_CS_HWE_EXPD_COMPID1_ADDR A:0x6606cff4
y.create.l HWIO_QDSS_WRAPPER_CS_HWE_EXPD_COMPID2_ADDR A:0x6606cff8
y.create.l HWIO_QDSS_WRAPPER_CS_HWE_EXPD_COMPID3_ADDR A:0x6606cffc
y.create.l HWIO_QDSS_WRAPPER_DEBUG_UI_SECURE_ADDR A:0x6606d000
y.create.l HWIO_QDSS_WRAPPER_DEBUG_UI_CTL_ADDR A:0x6606d004
y.create.l HWIO_QDSS_WRAPPER_DEBUG_UI_CTL_MASK_ADDR A:0x6606d008
y.create.l HWIO_QDSS_WRAPPER_DEBUG_UI_SWTRIG_ADDR A:0x6606d00c
y.create.l HWIO_QDSS_WRAPPER_DEBUG_UI_STATUS_ADDR A:0x6606d010
y.create.l HWIO_QDSS_WRAPPER_DEBUG_UI_HWE_MASK_ADDR A:0x6606d014
y.create.l HWIO_QDSS_WRAPPER_DEBUG_UI_CTR_VAL_ADDR A:0x6606d018
y.create.l HWIO_QDSS_WRAPPER_DEBUG_UI_CTR_EN_ADDR A:0x6606d01c
y.create.l HWIO_QDSS_WRAPPER_DEBUG_UI_NUM_REGS_RD_ADDR A:0x6606d020
y.create.l HWIO_QDSS_WRAPPER_DEBUG_UI_ATB_REG_ADDR A:0x6606d024
y.create.l HWIO_QDSS_WRAPPER_DEBUG_UI_NUM_ADDR_REG_ADDR A:0x6606d028
y.create.l HWIO_QDSS_WRAPPER_DEBUG_UI_ADDR_0_ADDR A:0x6606d030
y.create.l HWIO_QDSS_WRAPPER_DEBUG_UI_ADDR_1_ADDR A:0x6606d034
y.create.l HWIO_QDSS_WRAPPER_DEBUG_UI_ADDR_2_ADDR A:0x6606d038
y.create.l HWIO_QDSS_WRAPPER_DEBUG_UI_ADDR_3_ADDR A:0x6606d03c
y.create.l HWIO_QDSS_WRAPPER_DEBUG_UI_ADDR_4_ADDR A:0x6606d040
y.create.l HWIO_QDSS_WRAPPER_DEBUG_UI_ADDR_5_ADDR A:0x6606d044
y.create.l HWIO_QDSS_WRAPPER_DEBUG_UI_ADDR_6_ADDR A:0x6606d048
y.create.l HWIO_QDSS_WRAPPER_DEBUG_UI_ADDR_7_ADDR A:0x6606d04c
y.create.l HWIO_QDSS_WRAPPER_DEBUG_UI_ADDR_8_ADDR A:0x6606d050
y.create.l HWIO_QDSS_WRAPPER_DEBUG_UI_ADDR_9_ADDR A:0x6606d054
y.create.l HWIO_QDSS_WRAPPER_DEBUG_UI_ADDR_10_ADDR A:0x6606d058
y.create.l HWIO_QDSS_WRAPPER_DEBUG_UI_ADDR_11_ADDR A:0x6606d05c
y.create.l HWIO_QDSS_WRAPPER_DEBUG_UI_ADDR_12_ADDR A:0x6606d060
y.create.l HWIO_QDSS_WRAPPER_DEBUG_UI_DATA_0_ADDR A:0x6606d0b0
y.create.l HWIO_QDSS_WRAPPER_DEBUG_UI_DATA_1_ADDR A:0x6606d0b4
y.create.l HWIO_QDSS_WRAPPER_DEBUG_UI_DATA_2_ADDR A:0x6606d0b8
y.create.l HWIO_QDSS_WRAPPER_DEBUG_UI_DATA_3_ADDR A:0x6606d0bc
y.create.l HWIO_QDSS_WRAPPER_DEBUG_UI_DATA_4_ADDR A:0x6606d0c0
y.create.l HWIO_QDSS_WRAPPER_DEBUG_UI_DATA_5_ADDR A:0x6606d0c4
y.create.l HWIO_QDSS_WRAPPER_DEBUG_UI_DATA_6_ADDR A:0x6606d0c8
y.create.l HWIO_QDSS_WRAPPER_DEBUG_UI_DATA_7_ADDR A:0x6606d0cc
y.create.l HWIO_QDSS_WRAPPER_DEBUG_UI_DATA_8_ADDR A:0x6606d0d0
y.create.l HWIO_QDSS_WRAPPER_DEBUG_UI_DATA_9_ADDR A:0x6606d0d4
y.create.l HWIO_QDSS_WRAPPER_CS_DEBUG_UI_ITCTL_ADDR A:0x6606df00
y.create.l HWIO_QDSS_WRAPPER_CS_DEBUG_UI_CLAIMSET_ADDR A:0x6606dfa0
y.create.l HWIO_QDSS_WRAPPER_CS_DEBUG_UI_CLAIMCLR_ADDR A:0x6606dfa4
y.create.l HWIO_QDSS_WRAPPER_CS_DEBUG_UI_LOCKACCESS_ADDR A:0x6606dfb0
y.create.l HWIO_QDSS_WRAPPER_CS_DEBUG_UI_LOCKSTATUS_ADDR A:0x6606dfb4
y.create.l HWIO_QDSS_WRAPPER_CS_DEBUG_UI_AUTHSTATUS_ADDR A:0x6606dfb8
y.create.l HWIO_QDSS_WRAPPER_CS_DEBUG_UI_DEVICEID_ADDR A:0x6606dfc8
y.create.l HWIO_QDSS_WRAPPER_CS_DEBUG_UI_DEVICETYPE_ADDR A:0x6606dfcc
y.create.l HWIO_QDSS_WRAPPER_CS_DEBUG_UI_PERIPHID4_ADDR A:0x6606dfd0
y.create.l HWIO_QDSS_WRAPPER_CS_DEBUG_UI_PERIPHID5_ADDR A:0x6606dfd4
y.create.l HWIO_QDSS_WRAPPER_CS_DEBUG_UI_PERIPHID6_ADDR A:0x6606dfd8
y.create.l HWIO_QDSS_WRAPPER_CS_DEBUG_UI_PERIPHID7_ADDR A:0x6606dfdc
y.create.l HWIO_QDSS_WRAPPER_CS_DEBUG_UI_PERIPHID0_ADDR A:0x6606dfe0
y.create.l HWIO_QDSS_WRAPPER_CS_DEBUG_UI_PERIPHID1_ADDR A:0x6606dfe4
y.create.l HWIO_QDSS_WRAPPER_CS_DEBUG_UI_PERIPHID2_ADDR A:0x6606dfe8
y.create.l HWIO_QDSS_WRAPPER_CS_DEBUG_UI_PERIPHID3_ADDR A:0x6606dfec
y.create.l HWIO_QDSS_WRAPPER_CS_DEBUG_UI_COMPID0_ADDR A:0x6606dff0
y.create.l HWIO_QDSS_WRAPPER_CS_DEBUG_UI_COMPID1_ADDR A:0x6606dff4
y.create.l HWIO_QDSS_WRAPPER_CS_DEBUG_UI_COMPID2_ADDR A:0x6606dff8
y.create.l HWIO_QDSS_WRAPPER_CS_DEBUG_UI_COMPID3_ADDR A:0x6606dffc
y.create.l HWIO_QPIC_QPIC_BAM_CTRL_ADDR A:0x67984000
y.create.l HWIO_QPIC_QPIC_BAM_TIMER_ADDR A:0x67984040
y.create.l HWIO_QPIC_QPIC_BAM_TIMER_CTRL_ADDR A:0x67984044
y.create.l HWIO_QPIC_QPIC_BAM_DESC_CNT_TRSHLD_ADDR A:0x67984008
y.create.l HWIO_QPIC_QPIC_BAM_IRQ_STTS_ADDR A:0x67984014
y.create.l HWIO_QPIC_QPIC_BAM_IRQ_CLR_ADDR A:0x67984018
y.create.l HWIO_QPIC_QPIC_BAM_IRQ_EN_ADDR A:0x6798401c
y.create.l HWIO_QPIC_QPIC_BAM_CNFG_BITS_ADDR A:0x6798407c
y.create.l HWIO_QPIC_QPIC_BAM_REVISION_ADDR A:0x67985000
y.create.l HWIO_QPIC_QPIC_BAM_SW_VERSION_ADDR A:0x67985004
y.create.l HWIO_QPIC_QPIC_BAM_NUM_PIPES_ADDR A:0x67985008
y.create.l HWIO_QPIC_QPIC_BAM_TEST_BUS_SEL_ADDR A:0x67985010
y.create.l HWIO_QPIC_QPIC_BAM_TEST_BUS_REG_ADDR A:0x67985014
y.create.l HWIO_QPIC_QPIC_BAM_AHB_MASTER_ERR_CTRLS_ADDR A:0x67985024
y.create.l HWIO_QPIC_QPIC_BAM_AHB_MASTER_ERR_ADDR_ADDR A:0x67985028
y.create.l HWIO_QPIC_QPIC_BAM_AHB_MASTER_ERR_DATA_ADDR A:0x6798502c
y.create.l HWIO_QPIC_QPIC_BAM_AHB_MASTER_ERR_ADDR_LSB_ADDR A:0x67985100
y.create.l HWIO_QPIC_QPIC_BAM_AHB_MASTER_ERR_ADDR_MSB_ADDR A:0x67985104
y.create.l HWIO_QPIC_QPIC_BAM_TRUST_REG_ADDR A:0x67986000
y.create.l HWIO_QPIC_QPIC_BAM_P_TRUST_REG0_ADDR A:0x67986020
y.create.l HWIO_QPIC_QPIC_BAM_P_TRUST_REG1_ADDR A:0x67986024
y.create.l HWIO_QPIC_QPIC_BAM_P_TRUST_REG2_ADDR A:0x67986028
y.create.l HWIO_QPIC_QPIC_BAM_P_TRUST_REG3_ADDR A:0x6798602c
y.create.l HWIO_QPIC_QPIC_BAM_P_TRUST_REG4_ADDR A:0x67986030
y.create.l HWIO_QPIC_QPIC_BAM_P_TRUST_REG5_ADDR A:0x67986034
y.create.l HWIO_QPIC_QPIC_BAM_P_TRUST_REG6_ADDR A:0x67986038
y.create.l HWIO_QPIC_QPIC_BAM_IRQ_SRCS_EE0_ADDR A:0x67987000
y.create.l HWIO_QPIC_QPIC_BAM_IRQ_SRCS_EE1_ADDR A:0x67988000
y.create.l HWIO_QPIC_QPIC_BAM_IRQ_SRCS_EE2_ADDR A:0x67989000
y.create.l HWIO_QPIC_QPIC_BAM_IRQ_SRCS_EE3_ADDR A:0x6798a000
y.create.l HWIO_QPIC_QPIC_BAM_IRQ_SRCS_EE4_ADDR A:0x6798b000
y.create.l HWIO_QPIC_QPIC_BAM_IRQ_SRCS_EE5_ADDR A:0x6798c000
y.create.l HWIO_QPIC_QPIC_BAM_IRQ_SRCS_EE6_ADDR A:0x6798d000
y.create.l HWIO_QPIC_QPIC_BAM_IRQ_SRCS_EE7_ADDR A:0x6798e000
y.create.l HWIO_QPIC_QPIC_BAM_IRQ_SRCS_MSK_EE0_ADDR A:0x67987004
y.create.l HWIO_QPIC_QPIC_BAM_IRQ_SRCS_MSK_EE1_ADDR A:0x67988004
y.create.l HWIO_QPIC_QPIC_BAM_IRQ_SRCS_MSK_EE2_ADDR A:0x67989004
y.create.l HWIO_QPIC_QPIC_BAM_IRQ_SRCS_MSK_EE3_ADDR A:0x6798a004
y.create.l HWIO_QPIC_QPIC_BAM_IRQ_SRCS_MSK_EE4_ADDR A:0x6798b004
y.create.l HWIO_QPIC_QPIC_BAM_IRQ_SRCS_MSK_EE5_ADDR A:0x6798c004
y.create.l HWIO_QPIC_QPIC_BAM_IRQ_SRCS_MSK_EE6_ADDR A:0x6798d004
y.create.l HWIO_QPIC_QPIC_BAM_IRQ_SRCS_MSK_EE7_ADDR A:0x6798e004
y.create.l HWIO_QPIC_QPIC_BAM_IRQ_SRCS_UNMASKED_EE0_ADDR A:0x67987008
y.create.l HWIO_QPIC_QPIC_BAM_IRQ_SRCS_UNMASKED_EE1_ADDR A:0x67988008
y.create.l HWIO_QPIC_QPIC_BAM_IRQ_SRCS_UNMASKED_EE2_ADDR A:0x67989008
y.create.l HWIO_QPIC_QPIC_BAM_IRQ_SRCS_UNMASKED_EE3_ADDR A:0x6798a008
y.create.l HWIO_QPIC_QPIC_BAM_IRQ_SRCS_UNMASKED_EE4_ADDR A:0x6798b008
y.create.l HWIO_QPIC_QPIC_BAM_IRQ_SRCS_UNMASKED_EE5_ADDR A:0x6798c008
y.create.l HWIO_QPIC_QPIC_BAM_IRQ_SRCS_UNMASKED_EE6_ADDR A:0x6798d008
y.create.l HWIO_QPIC_QPIC_BAM_IRQ_SRCS_UNMASKED_EE7_ADDR A:0x6798e008
y.create.l HWIO_QPIC_QPIC_BAM_PIPE_ATTR_EE0_ADDR A:0x6798700c
y.create.l HWIO_QPIC_QPIC_BAM_PIPE_ATTR_EE1_ADDR A:0x6798800c
y.create.l HWIO_QPIC_QPIC_BAM_PIPE_ATTR_EE2_ADDR A:0x6798900c
y.create.l HWIO_QPIC_QPIC_BAM_PIPE_ATTR_EE3_ADDR A:0x6798a00c
y.create.l HWIO_QPIC_QPIC_BAM_PIPE_ATTR_EE4_ADDR A:0x6798b00c
y.create.l HWIO_QPIC_QPIC_BAM_PIPE_ATTR_EE5_ADDR A:0x6798c00c
y.create.l HWIO_QPIC_QPIC_BAM_PIPE_ATTR_EE6_ADDR A:0x6798d00c
y.create.l HWIO_QPIC_QPIC_BAM_PIPE_ATTR_EE7_ADDR A:0x6798e00c
y.create.l HWIO_QPIC_QPIC_BAM_IRQ_SRCS_ADDR A:0x67987010
y.create.l HWIO_QPIC_QPIC_BAM_IRQ_SRCS_MSK_ADDR A:0x67987014
y.create.l HWIO_QPIC_QPIC_BAM_IRQ_SRCS_UNMASKED_ADDR A:0x67987018
y.create.l HWIO_QPIC_QPIC_BAM_P_CTRL0_ADDR A:0x67997000
y.create.l HWIO_QPIC_QPIC_BAM_P_CTRL1_ADDR A:0x67998000
y.create.l HWIO_QPIC_QPIC_BAM_P_CTRL2_ADDR A:0x67999000
y.create.l HWIO_QPIC_QPIC_BAM_P_CTRL3_ADDR A:0x6799a000
y.create.l HWIO_QPIC_QPIC_BAM_P_CTRL4_ADDR A:0x6799b000
y.create.l HWIO_QPIC_QPIC_BAM_P_CTRL5_ADDR A:0x6799c000
y.create.l HWIO_QPIC_QPIC_BAM_P_CTRL6_ADDR A:0x6799d000
y.create.l HWIO_QPIC_QPIC_BAM_P_RST0_ADDR A:0x67997004
y.create.l HWIO_QPIC_QPIC_BAM_P_RST1_ADDR A:0x67998004
y.create.l HWIO_QPIC_QPIC_BAM_P_RST2_ADDR A:0x67999004
y.create.l HWIO_QPIC_QPIC_BAM_P_RST3_ADDR A:0x6799a004
y.create.l HWIO_QPIC_QPIC_BAM_P_RST4_ADDR A:0x6799b004
y.create.l HWIO_QPIC_QPIC_BAM_P_RST5_ADDR A:0x6799c004
y.create.l HWIO_QPIC_QPIC_BAM_P_RST6_ADDR A:0x6799d004
y.create.l HWIO_QPIC_QPIC_BAM_P_HALT0_ADDR A:0x67997008
y.create.l HWIO_QPIC_QPIC_BAM_P_HALT1_ADDR A:0x67998008
y.create.l HWIO_QPIC_QPIC_BAM_P_HALT2_ADDR A:0x67999008
y.create.l HWIO_QPIC_QPIC_BAM_P_HALT3_ADDR A:0x6799a008
y.create.l HWIO_QPIC_QPIC_BAM_P_HALT4_ADDR A:0x6799b008
y.create.l HWIO_QPIC_QPIC_BAM_P_HALT5_ADDR A:0x6799c008
y.create.l HWIO_QPIC_QPIC_BAM_P_HALT6_ADDR A:0x6799d008
y.create.l HWIO_QPIC_QPIC_BAM_P_IRQ_STTS0_ADDR A:0x67997010
y.create.l HWIO_QPIC_QPIC_BAM_P_IRQ_STTS1_ADDR A:0x67998010
y.create.l HWIO_QPIC_QPIC_BAM_P_IRQ_STTS2_ADDR A:0x67999010
y.create.l HWIO_QPIC_QPIC_BAM_P_IRQ_STTS3_ADDR A:0x6799a010
y.create.l HWIO_QPIC_QPIC_BAM_P_IRQ_STTS4_ADDR A:0x6799b010
y.create.l HWIO_QPIC_QPIC_BAM_P_IRQ_STTS5_ADDR A:0x6799c010
y.create.l HWIO_QPIC_QPIC_BAM_P_IRQ_STTS6_ADDR A:0x6799d010
y.create.l HWIO_QPIC_QPIC_BAM_P_IRQ_CLR0_ADDR A:0x67997014
y.create.l HWIO_QPIC_QPIC_BAM_P_IRQ_CLR1_ADDR A:0x67998014
y.create.l HWIO_QPIC_QPIC_BAM_P_IRQ_CLR2_ADDR A:0x67999014
y.create.l HWIO_QPIC_QPIC_BAM_P_IRQ_CLR3_ADDR A:0x6799a014
y.create.l HWIO_QPIC_QPIC_BAM_P_IRQ_CLR4_ADDR A:0x6799b014
y.create.l HWIO_QPIC_QPIC_BAM_P_IRQ_CLR5_ADDR A:0x6799c014
y.create.l HWIO_QPIC_QPIC_BAM_P_IRQ_CLR6_ADDR A:0x6799d014
y.create.l HWIO_QPIC_QPIC_BAM_P_IRQ_EN0_ADDR A:0x67997018
y.create.l HWIO_QPIC_QPIC_BAM_P_IRQ_EN1_ADDR A:0x67998018
y.create.l HWIO_QPIC_QPIC_BAM_P_IRQ_EN2_ADDR A:0x67999018
y.create.l HWIO_QPIC_QPIC_BAM_P_IRQ_EN3_ADDR A:0x6799a018
y.create.l HWIO_QPIC_QPIC_BAM_P_IRQ_EN4_ADDR A:0x6799b018
y.create.l HWIO_QPIC_QPIC_BAM_P_IRQ_EN5_ADDR A:0x6799c018
y.create.l HWIO_QPIC_QPIC_BAM_P_IRQ_EN6_ADDR A:0x6799d018
y.create.l HWIO_QPIC_QPIC_BAM_P_TIMER0_ADDR A:0x6799701c
y.create.l HWIO_QPIC_QPIC_BAM_P_TIMER1_ADDR A:0x6799801c
y.create.l HWIO_QPIC_QPIC_BAM_P_TIMER2_ADDR A:0x6799901c
y.create.l HWIO_QPIC_QPIC_BAM_P_TIMER3_ADDR A:0x6799a01c
y.create.l HWIO_QPIC_QPIC_BAM_P_TIMER4_ADDR A:0x6799b01c
y.create.l HWIO_QPIC_QPIC_BAM_P_TIMER5_ADDR A:0x6799c01c
y.create.l HWIO_QPIC_QPIC_BAM_P_TIMER6_ADDR A:0x6799d01c
y.create.l HWIO_QPIC_QPIC_BAM_P_TIMER_CTRL0_ADDR A:0x67997020
y.create.l HWIO_QPIC_QPIC_BAM_P_TIMER_CTRL1_ADDR A:0x67998020
y.create.l HWIO_QPIC_QPIC_BAM_P_TIMER_CTRL2_ADDR A:0x67999020
y.create.l HWIO_QPIC_QPIC_BAM_P_TIMER_CTRL3_ADDR A:0x6799a020
y.create.l HWIO_QPIC_QPIC_BAM_P_TIMER_CTRL4_ADDR A:0x6799b020
y.create.l HWIO_QPIC_QPIC_BAM_P_TIMER_CTRL5_ADDR A:0x6799c020
y.create.l HWIO_QPIC_QPIC_BAM_P_TIMER_CTRL6_ADDR A:0x6799d020
y.create.l HWIO_QPIC_QPIC_BAM_P_PRDCR_SDBND0_ADDR A:0x67997024
y.create.l HWIO_QPIC_QPIC_BAM_P_PRDCR_SDBND1_ADDR A:0x67998024
y.create.l HWIO_QPIC_QPIC_BAM_P_PRDCR_SDBND2_ADDR A:0x67999024
y.create.l HWIO_QPIC_QPIC_BAM_P_PRDCR_SDBND3_ADDR A:0x6799a024
y.create.l HWIO_QPIC_QPIC_BAM_P_PRDCR_SDBND4_ADDR A:0x6799b024
y.create.l HWIO_QPIC_QPIC_BAM_P_PRDCR_SDBND5_ADDR A:0x6799c024
y.create.l HWIO_QPIC_QPIC_BAM_P_PRDCR_SDBND6_ADDR A:0x6799d024
y.create.l HWIO_QPIC_QPIC_BAM_P_CNSMR_SDBND0_ADDR A:0x67997028
y.create.l HWIO_QPIC_QPIC_BAM_P_CNSMR_SDBND1_ADDR A:0x67998028
y.create.l HWIO_QPIC_QPIC_BAM_P_CNSMR_SDBND2_ADDR A:0x67999028
y.create.l HWIO_QPIC_QPIC_BAM_P_CNSMR_SDBND3_ADDR A:0x6799a028
y.create.l HWIO_QPIC_QPIC_BAM_P_CNSMR_SDBND4_ADDR A:0x6799b028
y.create.l HWIO_QPIC_QPIC_BAM_P_CNSMR_SDBND5_ADDR A:0x6799c028
y.create.l HWIO_QPIC_QPIC_BAM_P_CNSMR_SDBND6_ADDR A:0x6799d028
y.create.l HWIO_QPIC_QPIC_BAM_P_SW_OFSTS0_ADDR A:0x67997800
y.create.l HWIO_QPIC_QPIC_BAM_P_SW_OFSTS1_ADDR A:0x67998800
y.create.l HWIO_QPIC_QPIC_BAM_P_SW_OFSTS2_ADDR A:0x67999800
y.create.l HWIO_QPIC_QPIC_BAM_P_SW_OFSTS3_ADDR A:0x6799a800
y.create.l HWIO_QPIC_QPIC_BAM_P_SW_OFSTS4_ADDR A:0x6799b800
y.create.l HWIO_QPIC_QPIC_BAM_P_SW_OFSTS5_ADDR A:0x6799c800
y.create.l HWIO_QPIC_QPIC_BAM_P_SW_OFSTS6_ADDR A:0x6799d800
y.create.l HWIO_QPIC_QPIC_BAM_P_AU_PSM_CNTXT_1_0_ADDR A:0x67997804
y.create.l HWIO_QPIC_QPIC_BAM_P_AU_PSM_CNTXT_1_1_ADDR A:0x67998804
y.create.l HWIO_QPIC_QPIC_BAM_P_AU_PSM_CNTXT_1_2_ADDR A:0x67999804
y.create.l HWIO_QPIC_QPIC_BAM_P_AU_PSM_CNTXT_1_3_ADDR A:0x6799a804
y.create.l HWIO_QPIC_QPIC_BAM_P_AU_PSM_CNTXT_1_4_ADDR A:0x6799b804
y.create.l HWIO_QPIC_QPIC_BAM_P_AU_PSM_CNTXT_1_5_ADDR A:0x6799c804
y.create.l HWIO_QPIC_QPIC_BAM_P_AU_PSM_CNTXT_1_6_ADDR A:0x6799d804
y.create.l HWIO_QPIC_QPIC_BAM_P_PSM_CNTXT_2_0_ADDR A:0x67997808
y.create.l HWIO_QPIC_QPIC_BAM_P_PSM_CNTXT_2_1_ADDR A:0x67998808
y.create.l HWIO_QPIC_QPIC_BAM_P_PSM_CNTXT_2_2_ADDR A:0x67999808
y.create.l HWIO_QPIC_QPIC_BAM_P_PSM_CNTXT_2_3_ADDR A:0x6799a808
y.create.l HWIO_QPIC_QPIC_BAM_P_PSM_CNTXT_2_4_ADDR A:0x6799b808
y.create.l HWIO_QPIC_QPIC_BAM_P_PSM_CNTXT_2_5_ADDR A:0x6799c808
y.create.l HWIO_QPIC_QPIC_BAM_P_PSM_CNTXT_2_6_ADDR A:0x6799d808
y.create.l HWIO_QPIC_QPIC_BAM_P_PSM_CNTXT_3_0_ADDR A:0x6799780c
y.create.l HWIO_QPIC_QPIC_BAM_P_PSM_CNTXT_3_1_ADDR A:0x6799880c
y.create.l HWIO_QPIC_QPIC_BAM_P_PSM_CNTXT_3_2_ADDR A:0x6799980c
y.create.l HWIO_QPIC_QPIC_BAM_P_PSM_CNTXT_3_3_ADDR A:0x6799a80c
y.create.l HWIO_QPIC_QPIC_BAM_P_PSM_CNTXT_3_4_ADDR A:0x6799b80c
y.create.l HWIO_QPIC_QPIC_BAM_P_PSM_CNTXT_3_5_ADDR A:0x6799c80c
y.create.l HWIO_QPIC_QPIC_BAM_P_PSM_CNTXT_3_6_ADDR A:0x6799d80c
y.create.l HWIO_QPIC_QPIC_BAM_P_PSM_CNTXT_4_0_ADDR A:0x67997810
y.create.l HWIO_QPIC_QPIC_BAM_P_PSM_CNTXT_4_1_ADDR A:0x67998810
y.create.l HWIO_QPIC_QPIC_BAM_P_PSM_CNTXT_4_2_ADDR A:0x67999810
y.create.l HWIO_QPIC_QPIC_BAM_P_PSM_CNTXT_4_3_ADDR A:0x6799a810
y.create.l HWIO_QPIC_QPIC_BAM_P_PSM_CNTXT_4_4_ADDR A:0x6799b810
y.create.l HWIO_QPIC_QPIC_BAM_P_PSM_CNTXT_4_5_ADDR A:0x6799c810
y.create.l HWIO_QPIC_QPIC_BAM_P_PSM_CNTXT_4_6_ADDR A:0x6799d810
y.create.l HWIO_QPIC_QPIC_BAM_P_PSM_CNTXT_5_0_ADDR A:0x67997814
y.create.l HWIO_QPIC_QPIC_BAM_P_PSM_CNTXT_5_1_ADDR A:0x67998814
y.create.l HWIO_QPIC_QPIC_BAM_P_PSM_CNTXT_5_2_ADDR A:0x67999814
y.create.l HWIO_QPIC_QPIC_BAM_P_PSM_CNTXT_5_3_ADDR A:0x6799a814
y.create.l HWIO_QPIC_QPIC_BAM_P_PSM_CNTXT_5_4_ADDR A:0x6799b814
y.create.l HWIO_QPIC_QPIC_BAM_P_PSM_CNTXT_5_5_ADDR A:0x6799c814
y.create.l HWIO_QPIC_QPIC_BAM_P_PSM_CNTXT_5_6_ADDR A:0x6799d814
y.create.l HWIO_QPIC_QPIC_BAM_P_EVNT_REG0_ADDR A:0x67997818
y.create.l HWIO_QPIC_QPIC_BAM_P_EVNT_REG1_ADDR A:0x67998818
y.create.l HWIO_QPIC_QPIC_BAM_P_EVNT_REG2_ADDR A:0x67999818
y.create.l HWIO_QPIC_QPIC_BAM_P_EVNT_REG3_ADDR A:0x6799a818
y.create.l HWIO_QPIC_QPIC_BAM_P_EVNT_REG4_ADDR A:0x6799b818
y.create.l HWIO_QPIC_QPIC_BAM_P_EVNT_REG5_ADDR A:0x6799c818
y.create.l HWIO_QPIC_QPIC_BAM_P_EVNT_REG6_ADDR A:0x6799d818
y.create.l HWIO_QPIC_QPIC_BAM_P_DESC_FIFO_ADDR0_ADDR A:0x6799781c
y.create.l HWIO_QPIC_QPIC_BAM_P_DESC_FIFO_ADDR1_ADDR A:0x6799881c
y.create.l HWIO_QPIC_QPIC_BAM_P_DESC_FIFO_ADDR2_ADDR A:0x6799981c
y.create.l HWIO_QPIC_QPIC_BAM_P_DESC_FIFO_ADDR3_ADDR A:0x6799a81c
y.create.l HWIO_QPIC_QPIC_BAM_P_DESC_FIFO_ADDR4_ADDR A:0x6799b81c
y.create.l HWIO_QPIC_QPIC_BAM_P_DESC_FIFO_ADDR5_ADDR A:0x6799c81c
y.create.l HWIO_QPIC_QPIC_BAM_P_DESC_FIFO_ADDR6_ADDR A:0x6799d81c
y.create.l HWIO_QPIC_QPIC_BAM_P_FIFO_SIZES0_ADDR A:0x67997820
y.create.l HWIO_QPIC_QPIC_BAM_P_FIFO_SIZES1_ADDR A:0x67998820
y.create.l HWIO_QPIC_QPIC_BAM_P_FIFO_SIZES2_ADDR A:0x67999820
y.create.l HWIO_QPIC_QPIC_BAM_P_FIFO_SIZES3_ADDR A:0x6799a820
y.create.l HWIO_QPIC_QPIC_BAM_P_FIFO_SIZES4_ADDR A:0x6799b820
y.create.l HWIO_QPIC_QPIC_BAM_P_FIFO_SIZES5_ADDR A:0x6799c820
y.create.l HWIO_QPIC_QPIC_BAM_P_FIFO_SIZES6_ADDR A:0x6799d820
y.create.l HWIO_QPIC_QPIC_BAM_P_DATA_FIFO_ADDR0_ADDR A:0x67997824
y.create.l HWIO_QPIC_QPIC_BAM_P_DATA_FIFO_ADDR1_ADDR A:0x67998824
y.create.l HWIO_QPIC_QPIC_BAM_P_DATA_FIFO_ADDR2_ADDR A:0x67999824
y.create.l HWIO_QPIC_QPIC_BAM_P_DATA_FIFO_ADDR3_ADDR A:0x6799a824
y.create.l HWIO_QPIC_QPIC_BAM_P_DATA_FIFO_ADDR4_ADDR A:0x6799b824
y.create.l HWIO_QPIC_QPIC_BAM_P_DATA_FIFO_ADDR5_ADDR A:0x6799c824
y.create.l HWIO_QPIC_QPIC_BAM_P_DATA_FIFO_ADDR6_ADDR A:0x6799d824
y.create.l HWIO_QPIC_QPIC_BAM_P_EVNT_GEN_TRSHLD0_ADDR A:0x67997828
y.create.l HWIO_QPIC_QPIC_BAM_P_EVNT_GEN_TRSHLD1_ADDR A:0x67998828
y.create.l HWIO_QPIC_QPIC_BAM_P_EVNT_GEN_TRSHLD2_ADDR A:0x67999828
y.create.l HWIO_QPIC_QPIC_BAM_P_EVNT_GEN_TRSHLD3_ADDR A:0x6799a828
y.create.l HWIO_QPIC_QPIC_BAM_P_EVNT_GEN_TRSHLD4_ADDR A:0x6799b828
y.create.l HWIO_QPIC_QPIC_BAM_P_EVNT_GEN_TRSHLD5_ADDR A:0x6799c828
y.create.l HWIO_QPIC_QPIC_BAM_P_EVNT_GEN_TRSHLD6_ADDR A:0x6799d828
y.create.l HWIO_QPIC_QPIC_BAM_P_EVNT_DEST_ADDR0_ADDR A:0x6799782c
y.create.l HWIO_QPIC_QPIC_BAM_P_EVNT_DEST_ADDR1_ADDR A:0x6799882c
y.create.l HWIO_QPIC_QPIC_BAM_P_EVNT_DEST_ADDR2_ADDR A:0x6799982c
y.create.l HWIO_QPIC_QPIC_BAM_P_EVNT_DEST_ADDR3_ADDR A:0x6799a82c
y.create.l HWIO_QPIC_QPIC_BAM_P_EVNT_DEST_ADDR4_ADDR A:0x6799b82c
y.create.l HWIO_QPIC_QPIC_BAM_P_EVNT_DEST_ADDR5_ADDR A:0x6799c82c
y.create.l HWIO_QPIC_QPIC_BAM_P_EVNT_DEST_ADDR6_ADDR A:0x6799d82c
y.create.l HWIO_QPIC_QPIC_BAM_P_DF_CNTXT_0_ADDR A:0x67997830
y.create.l HWIO_QPIC_QPIC_BAM_P_DF_CNTXT_1_ADDR A:0x67998830
y.create.l HWIO_QPIC_QPIC_BAM_P_DF_CNTXT_2_ADDR A:0x67999830
y.create.l HWIO_QPIC_QPIC_BAM_P_DF_CNTXT_3_ADDR A:0x6799a830
y.create.l HWIO_QPIC_QPIC_BAM_P_DF_CNTXT_4_ADDR A:0x6799b830
y.create.l HWIO_QPIC_QPIC_BAM_P_DF_CNTXT_5_ADDR A:0x6799c830
y.create.l HWIO_QPIC_QPIC_BAM_P_DF_CNTXT_6_ADDR A:0x6799d830
y.create.l HWIO_QPIC_QPIC_BAM_P_RETR_CNTXT_0_ADDR A:0x67997834
y.create.l HWIO_QPIC_QPIC_BAM_P_RETR_CNTXT_1_ADDR A:0x67998834
y.create.l HWIO_QPIC_QPIC_BAM_P_RETR_CNTXT_2_ADDR A:0x67999834
y.create.l HWIO_QPIC_QPIC_BAM_P_RETR_CNTXT_3_ADDR A:0x6799a834
y.create.l HWIO_QPIC_QPIC_BAM_P_RETR_CNTXT_4_ADDR A:0x6799b834
y.create.l HWIO_QPIC_QPIC_BAM_P_RETR_CNTXT_5_ADDR A:0x6799c834
y.create.l HWIO_QPIC_QPIC_BAM_P_RETR_CNTXT_6_ADDR A:0x6799d834
y.create.l HWIO_QPIC_QPIC_BAM_P_SI_CNTXT_0_ADDR A:0x67997838
y.create.l HWIO_QPIC_QPIC_BAM_P_SI_CNTXT_1_ADDR A:0x67998838
y.create.l HWIO_QPIC_QPIC_BAM_P_SI_CNTXT_2_ADDR A:0x67999838
y.create.l HWIO_QPIC_QPIC_BAM_P_SI_CNTXT_3_ADDR A:0x6799a838
y.create.l HWIO_QPIC_QPIC_BAM_P_SI_CNTXT_4_ADDR A:0x6799b838
y.create.l HWIO_QPIC_QPIC_BAM_P_SI_CNTXT_5_ADDR A:0x6799c838
y.create.l HWIO_QPIC_QPIC_BAM_P_SI_CNTXT_6_ADDR A:0x6799d838
y.create.l HWIO_QPIC_QPIC_BAM_P_PSM_CNTXT_3_LSB0_ADDR A:0x67997900
y.create.l HWIO_QPIC_QPIC_BAM_P_PSM_CNTXT_3_LSB1_ADDR A:0x67998900
y.create.l HWIO_QPIC_QPIC_BAM_P_PSM_CNTXT_3_LSB2_ADDR A:0x67999900
y.create.l HWIO_QPIC_QPIC_BAM_P_PSM_CNTXT_3_LSB3_ADDR A:0x6799a900
y.create.l HWIO_QPIC_QPIC_BAM_P_PSM_CNTXT_3_LSB4_ADDR A:0x6799b900
y.create.l HWIO_QPIC_QPIC_BAM_P_PSM_CNTXT_3_LSB5_ADDR A:0x6799c900
y.create.l HWIO_QPIC_QPIC_BAM_P_PSM_CNTXT_3_LSB6_ADDR A:0x6799d900
y.create.l HWIO_QPIC_QPIC_BAM_P_PSM_CNTXT_3_MSB0_ADDR A:0x67997904
y.create.l HWIO_QPIC_QPIC_BAM_P_PSM_CNTXT_3_MSB1_ADDR A:0x67998904
y.create.l HWIO_QPIC_QPIC_BAM_P_PSM_CNTXT_3_MSB2_ADDR A:0x67999904
y.create.l HWIO_QPIC_QPIC_BAM_P_PSM_CNTXT_3_MSB3_ADDR A:0x6799a904
y.create.l HWIO_QPIC_QPIC_BAM_P_PSM_CNTXT_3_MSB4_ADDR A:0x6799b904
y.create.l HWIO_QPIC_QPIC_BAM_P_PSM_CNTXT_3_MSB5_ADDR A:0x6799c904
y.create.l HWIO_QPIC_QPIC_BAM_P_PSM_CNTXT_3_MSB6_ADDR A:0x6799d904
y.create.l HWIO_QPIC_QPIC_BAM_P_DESC_FIFO_ADDR_LSB0_ADDR A:0x67997910
y.create.l HWIO_QPIC_QPIC_BAM_P_DESC_FIFO_ADDR_LSB1_ADDR A:0x67998910
y.create.l HWIO_QPIC_QPIC_BAM_P_DESC_FIFO_ADDR_LSB2_ADDR A:0x67999910
y.create.l HWIO_QPIC_QPIC_BAM_P_DESC_FIFO_ADDR_LSB3_ADDR A:0x6799a910
y.create.l HWIO_QPIC_QPIC_BAM_P_DESC_FIFO_ADDR_LSB4_ADDR A:0x6799b910
y.create.l HWIO_QPIC_QPIC_BAM_P_DESC_FIFO_ADDR_LSB5_ADDR A:0x6799c910
y.create.l HWIO_QPIC_QPIC_BAM_P_DESC_FIFO_ADDR_LSB6_ADDR A:0x6799d910
y.create.l HWIO_QPIC_QPIC_BAM_P_DESC_FIFO_ADDR_MSB0_ADDR A:0x67997914
y.create.l HWIO_QPIC_QPIC_BAM_P_DESC_FIFO_ADDR_MSB1_ADDR A:0x67998914
y.create.l HWIO_QPIC_QPIC_BAM_P_DESC_FIFO_ADDR_MSB2_ADDR A:0x67999914
y.create.l HWIO_QPIC_QPIC_BAM_P_DESC_FIFO_ADDR_MSB3_ADDR A:0x6799a914
y.create.l HWIO_QPIC_QPIC_BAM_P_DESC_FIFO_ADDR_MSB4_ADDR A:0x6799b914
y.create.l HWIO_QPIC_QPIC_BAM_P_DESC_FIFO_ADDR_MSB5_ADDR A:0x6799c914
y.create.l HWIO_QPIC_QPIC_BAM_P_DESC_FIFO_ADDR_MSB6_ADDR A:0x6799d914
y.create.l HWIO_QPIC_QPIC_BAM_P_DATA_FIFO_ADDR_LSB0_ADDR A:0x67997920
y.create.l HWIO_QPIC_QPIC_BAM_P_DATA_FIFO_ADDR_LSB1_ADDR A:0x67998920
y.create.l HWIO_QPIC_QPIC_BAM_P_DATA_FIFO_ADDR_LSB2_ADDR A:0x67999920
y.create.l HWIO_QPIC_QPIC_BAM_P_DATA_FIFO_ADDR_LSB3_ADDR A:0x6799a920
y.create.l HWIO_QPIC_QPIC_BAM_P_DATA_FIFO_ADDR_LSB4_ADDR A:0x6799b920
y.create.l HWIO_QPIC_QPIC_BAM_P_DATA_FIFO_ADDR_LSB5_ADDR A:0x6799c920
y.create.l HWIO_QPIC_QPIC_BAM_P_DATA_FIFO_ADDR_LSB6_ADDR A:0x6799d920
y.create.l HWIO_QPIC_QPIC_BAM_P_DATA_FIFO_ADDR_MSB0_ADDR A:0x67997924
y.create.l HWIO_QPIC_QPIC_BAM_P_DATA_FIFO_ADDR_MSB1_ADDR A:0x67998924
y.create.l HWIO_QPIC_QPIC_BAM_P_DATA_FIFO_ADDR_MSB2_ADDR A:0x67999924
y.create.l HWIO_QPIC_QPIC_BAM_P_DATA_FIFO_ADDR_MSB3_ADDR A:0x6799a924
y.create.l HWIO_QPIC_QPIC_BAM_P_DATA_FIFO_ADDR_MSB4_ADDR A:0x6799b924
y.create.l HWIO_QPIC_QPIC_BAM_P_DATA_FIFO_ADDR_MSB5_ADDR A:0x6799c924
y.create.l HWIO_QPIC_QPIC_BAM_P_DATA_FIFO_ADDR_MSB6_ADDR A:0x6799d924
y.create.l HWIO_QPIC_QPIC_BAM_P_EVNT_DEST_ADDR_LSB0_ADDR A:0x67997930
y.create.l HWIO_QPIC_QPIC_BAM_P_EVNT_DEST_ADDR_LSB1_ADDR A:0x67998930
y.create.l HWIO_QPIC_QPIC_BAM_P_EVNT_DEST_ADDR_LSB2_ADDR A:0x67999930
y.create.l HWIO_QPIC_QPIC_BAM_P_EVNT_DEST_ADDR_LSB3_ADDR A:0x6799a930
y.create.l HWIO_QPIC_QPIC_BAM_P_EVNT_DEST_ADDR_LSB4_ADDR A:0x6799b930
y.create.l HWIO_QPIC_QPIC_BAM_P_EVNT_DEST_ADDR_LSB5_ADDR A:0x6799c930
y.create.l HWIO_QPIC_QPIC_BAM_P_EVNT_DEST_ADDR_LSB6_ADDR A:0x6799d930
y.create.l HWIO_QPIC_QPIC_BAM_P_EVNT_DEST_ADDR_MSB0_ADDR A:0x67997934
y.create.l HWIO_QPIC_QPIC_BAM_P_EVNT_DEST_ADDR_MSB1_ADDR A:0x67998934
y.create.l HWIO_QPIC_QPIC_BAM_P_EVNT_DEST_ADDR_MSB2_ADDR A:0x67999934
y.create.l HWIO_QPIC_QPIC_BAM_P_EVNT_DEST_ADDR_MSB3_ADDR A:0x6799a934
y.create.l HWIO_QPIC_QPIC_BAM_P_EVNT_DEST_ADDR_MSB4_ADDR A:0x6799b934
y.create.l HWIO_QPIC_QPIC_BAM_P_EVNT_DEST_ADDR_MSB5_ADDR A:0x6799c934
y.create.l HWIO_QPIC_QPIC_BAM_P_EVNT_DEST_ADDR_MSB6_ADDR A:0x6799d934
y.create.l HWIO_QPIC_QPIC_XPU_SCR_ADDR A:0x67982000
y.create.l HWIO_QPIC_QPIC_XPU_SWDR_ADDR A:0x67982004
y.create.l HWIO_QPIC_QPIC_XPU_SEAR0_ADDR A:0x67982040
y.create.l HWIO_QPIC_QPIC_XPU_SESR_ADDR A:0x67982048
y.create.l HWIO_QPIC_QPIC_XPU_SESRRESTORE_ADDR A:0x6798204c
y.create.l HWIO_QPIC_QPIC_XPU_SESYNR0_ADDR A:0x67982050
y.create.l HWIO_QPIC_QPIC_XPU_SESYNR1_ADDR A:0x67982054
y.create.l HWIO_QPIC_QPIC_XPU_SESYNR2_ADDR A:0x67982058
y.create.l HWIO_QPIC_QPIC_XPU_MCR_ADDR A:0x67982100
y.create.l HWIO_QPIC_QPIC_XPU_MEAR0_ADDR A:0x67982140
y.create.l HWIO_QPIC_QPIC_XPU_MESR_ADDR A:0x67982148
y.create.l HWIO_QPIC_QPIC_XPU_MESRRESTORE_ADDR A:0x6798214c
y.create.l HWIO_QPIC_QPIC_XPU_MESYNR0_ADDR A:0x67982150
y.create.l HWIO_QPIC_QPIC_XPU_MESYNR1_ADDR A:0x67982154
y.create.l HWIO_QPIC_QPIC_XPU_MESYNR2_ADDR A:0x67982158
y.create.l HWIO_QPIC_QPIC_XPU_CR_ADDR A:0x67982080
y.create.l HWIO_QPIC_QPIC_XPU_RPU_ACR0_ADDR A:0x679820a0
y.create.l HWIO_QPIC_QPIC_XPU_EAR0_ADDR A:0x679820c0
y.create.l HWIO_QPIC_QPIC_XPU_ESR_ADDR A:0x679820c8
y.create.l HWIO_QPIC_QPIC_XPU_ESRRESTORE_ADDR A:0x679820cc
y.create.l HWIO_QPIC_QPIC_XPU_ESYNR0_ADDR A:0x679820d0
y.create.l HWIO_QPIC_QPIC_XPU_ESYNR1_ADDR A:0x679820d4
y.create.l HWIO_QPIC_QPIC_XPU_ESYNR2_ADDR A:0x679820d8
y.create.l HWIO_QPIC_QPIC_XPU_IDR0_ADDR A:0x67982074
y.create.l HWIO_QPIC_QPIC_XPU_IDR1_ADDR A:0x67982078
y.create.l HWIO_QPIC_QPIC_XPU_REV_ADDR A:0x6798207c
y.create.l HWIO_QPIC_QPIC_XPU_RG0_RACR0_ADDR A:0x67982200
y.create.l HWIO_QPIC_QPIC_XPU_RG1_RACR0_ADDR A:0x67982280
y.create.l HWIO_QPIC_QPIC_XPU_RG2_RACR0_ADDR A:0x67982300
y.create.l HWIO_QPIC_QPIC_XPU_RG3_RACR0_ADDR A:0x67982380
y.create.l HWIO_QPIC_QPIC_XPU_RG4_RACR0_ADDR A:0x67982400
y.create.l HWIO_QPIC_QPIC_XPU_RG5_RACR0_ADDR A:0x67982480
y.create.l HWIO_QPIC_QPIC_XPU_RG6_RACR0_ADDR A:0x67982500
y.create.l HWIO_QPIC_QPIC_XPU_RG7_RACR0_ADDR A:0x67982580
y.create.l HWIO_QPIC_QPIC_XPU_RG8_RACR0_ADDR A:0x67982600
y.create.l HWIO_QPIC_QPIC_XPU_RG9_RACR0_ADDR A:0x67982680
y.create.l HWIO_QPIC_QPIC_XPU_RG0_SCR_ADDR A:0x67982250
y.create.l HWIO_QPIC_QPIC_XPU_RG1_SCR_ADDR A:0x679822d0
y.create.l HWIO_QPIC_QPIC_XPU_RG2_SCR_ADDR A:0x67982350
y.create.l HWIO_QPIC_QPIC_XPU_RG3_SCR_ADDR A:0x679823d0
y.create.l HWIO_QPIC_QPIC_XPU_RG4_SCR_ADDR A:0x67982450
y.create.l HWIO_QPIC_QPIC_XPU_RG5_SCR_ADDR A:0x679824d0
y.create.l HWIO_QPIC_QPIC_XPU_RG6_SCR_ADDR A:0x67982550
y.create.l HWIO_QPIC_QPIC_XPU_RG7_SCR_ADDR A:0x679825d0
y.create.l HWIO_QPIC_QPIC_XPU_RG8_SCR_ADDR A:0x67982650
y.create.l HWIO_QPIC_QPIC_XPU_RG9_SCR_ADDR A:0x679826d0
y.create.l HWIO_QPIC_QPIC_XPU_RG0_MCR_ADDR A:0x67982254
y.create.l HWIO_QPIC_QPIC_XPU_RG1_MCR_ADDR A:0x679822d4
y.create.l HWIO_QPIC_QPIC_XPU_RG2_MCR_ADDR A:0x67982354
y.create.l HWIO_QPIC_QPIC_XPU_RG3_MCR_ADDR A:0x679823d4
y.create.l HWIO_QPIC_QPIC_XPU_RG4_MCR_ADDR A:0x67982454
y.create.l HWIO_QPIC_QPIC_XPU_RG5_MCR_ADDR A:0x679824d4
y.create.l HWIO_QPIC_QPIC_XPU_RG6_MCR_ADDR A:0x67982554
y.create.l HWIO_QPIC_QPIC_XPU_RG7_MCR_ADDR A:0x679825d4
y.create.l HWIO_QPIC_QPIC_XPU_RG8_MCR_ADDR A:0x67982654
y.create.l HWIO_QPIC_QPIC_XPU_RG9_MCR_ADDR A:0x679826d4
y.create.l HWIO_QPIC_QPIC_VMIDMT_SCR0_ADDR A:0x67980000
y.create.l HWIO_QPIC_QPIC_VMIDMT_SCR1_ADDR A:0x67980004
y.create.l HWIO_QPIC_QPIC_VMIDMT_SCR2_ADDR A:0x67980008
y.create.l HWIO_QPIC_QPIC_VMIDMT_SACR_ADDR A:0x67980010
y.create.l HWIO_QPIC_QPIC_VMIDMT_SIDR0_ADDR A:0x67980020
y.create.l HWIO_QPIC_QPIC_VMIDMT_SIDR1_ADDR A:0x67980024
y.create.l HWIO_QPIC_QPIC_VMIDMT_SIDR2_ADDR A:0x67980028
y.create.l HWIO_QPIC_QPIC_VMIDMT_SIDR4_ADDR A:0x67980030
y.create.l HWIO_QPIC_QPIC_VMIDMT_SIDR5_ADDR A:0x67980034
y.create.l HWIO_QPIC_QPIC_VMIDMT_SIDR7_ADDR A:0x6798003c
y.create.l HWIO_QPIC_QPIC_VMIDMT_SGFAR0_ADDR A:0x67980040
y.create.l HWIO_QPIC_QPIC_VMIDMT_SGFSR_ADDR A:0x67980048
y.create.l HWIO_QPIC_QPIC_VMIDMT_SGFSRRESTORE_ADDR A:0x6798004c
y.create.l HWIO_QPIC_QPIC_VMIDMT_SGFSYNDR0_ADDR A:0x67980050
y.create.l HWIO_QPIC_QPIC_VMIDMT_SGFSYNDR1_ADDR A:0x67980054
y.create.l HWIO_QPIC_QPIC_VMIDMT_SGFSYNDR2_ADDR A:0x67980058
y.create.l HWIO_QPIC_QPIC_VMIDMT_VMIDMTSCR0_ADDR A:0x67980090
y.create.l HWIO_QPIC_QPIC_VMIDMT_CR0_ADDR A:0x67980000
y.create.l HWIO_QPIC_QPIC_VMIDMT_CR2_ADDR A:0x67980008
y.create.l HWIO_QPIC_QPIC_VMIDMT_ACR_ADDR A:0x67980010
y.create.l HWIO_QPIC_QPIC_VMIDMT_IDR0_ADDR A:0x67980020
y.create.l HWIO_QPIC_QPIC_VMIDMT_IDR1_ADDR A:0x67980024
y.create.l HWIO_QPIC_QPIC_VMIDMT_IDR2_ADDR A:0x67980028
y.create.l HWIO_QPIC_QPIC_VMIDMT_IDR4_ADDR A:0x67980030
y.create.l HWIO_QPIC_QPIC_VMIDMT_IDR5_ADDR A:0x67980034
y.create.l HWIO_QPIC_QPIC_VMIDMT_IDR7_ADDR A:0x6798003c
y.create.l HWIO_QPIC_QPIC_VMIDMT_GFAR0_ADDR A:0x67980040
y.create.l HWIO_QPIC_QPIC_VMIDMT_GFSR_ADDR A:0x67980048
y.create.l HWIO_QPIC_QPIC_VMIDMT_GFSRRESTORE_ADDR A:0x6798004c
y.create.l HWIO_QPIC_QPIC_VMIDMT_GFSYNDR0_ADDR A:0x67980050
y.create.l HWIO_QPIC_QPIC_VMIDMT_GFSYNDR1_ADDR A:0x67980054
y.create.l HWIO_QPIC_QPIC_VMIDMT_GFSYNDR2_ADDR A:0x67980058
y.create.l HWIO_QPIC_QPIC_VMIDMT_VMIDMTCR0_ADDR A:0x67980090
y.create.l HWIO_QPIC_QPIC_VMIDMT_VMIDMTACR_ADDR A:0x6798009c
y.create.l HWIO_QPIC_QPIC_VMIDMT_NSCR0_ADDR A:0x67980400
y.create.l HWIO_QPIC_QPIC_VMIDMT_NSCR2_ADDR A:0x67980408
y.create.l HWIO_QPIC_QPIC_VMIDMT_NSACR_ADDR A:0x67980410
y.create.l HWIO_QPIC_QPIC_VMIDMT_NSGFAR0_ADDR A:0x67980440
y.create.l HWIO_QPIC_QPIC_VMIDMT_NSGFSR_ADDR A:0x67980448
y.create.l HWIO_QPIC_QPIC_VMIDMT_NSGFSRRESTORE_ADDR A:0x6798044c
y.create.l HWIO_QPIC_QPIC_VMIDMT_NSGFSYNDR0_ADDR A:0x67980450
y.create.l HWIO_QPIC_QPIC_VMIDMT_NSGFSYNDR1_ADDR A:0x67980454
y.create.l HWIO_QPIC_QPIC_VMIDMT_NSGFSYNDR2_ADDR A:0x67980458
y.create.l HWIO_QPIC_QPIC_VMIDMT_NSVMIDMTCR0_ADDR A:0x67980490
y.create.l HWIO_QPIC_QPIC_VMIDMT_SSDR0_ADDR A:0x67980080
y.create.l HWIO_QPIC_QPIC_VMIDMT_MSDR0_ADDR A:0x67980480
y.create.l HWIO_QPIC_QPIC_VMIDMT_MCR_ADDR A:0x67980494
y.create.l HWIO_QPIC_QPIC_VMIDMT_S2VR0_ADDR A:0x67980c00
y.create.l HWIO_QPIC_QPIC_VMIDMT_S2VR1_ADDR A:0x67980c04
y.create.l HWIO_QPIC_QPIC_VMIDMT_S2VR2_ADDR A:0x67980c08
y.create.l HWIO_QPIC_QPIC_VMIDMT_S2VR3_ADDR A:0x67980c0c
y.create.l HWIO_QPIC_QPIC_VMIDMT_S2VR4_ADDR A:0x67980c10
y.create.l HWIO_QPIC_QPIC_VMIDMT_S2VR5_ADDR A:0x67980c14
y.create.l HWIO_QPIC_QPIC_VMIDMT_S2VR6_ADDR A:0x67980c18
y.create.l HWIO_QPIC_QPIC_VMIDMT_S2VR7_ADDR A:0x67980c1c
y.create.l HWIO_QPIC_QPIC_VMIDMT_AS2VR0_ADDR A:0x67980e00
y.create.l HWIO_QPIC_QPIC_VMIDMT_AS2VR1_ADDR A:0x67980e04
y.create.l HWIO_QPIC_QPIC_VMIDMT_AS2VR2_ADDR A:0x67980e08
y.create.l HWIO_QPIC_QPIC_VMIDMT_AS2VR3_ADDR A:0x67980e0c
y.create.l HWIO_QPIC_QPIC_VMIDMT_AS2VR4_ADDR A:0x67980e10
y.create.l HWIO_QPIC_QPIC_VMIDMT_AS2VR5_ADDR A:0x67980e14
y.create.l HWIO_QPIC_QPIC_VMIDMT_AS2VR6_ADDR A:0x67980e18
y.create.l HWIO_QPIC_QPIC_VMIDMT_AS2VR7_ADDR A:0x67980e1c
y.create.l HWIO_QPIC_QPIC_VMIDMT_SMR0_ADDR A:0x67980800
y.create.l HWIO_QPIC_QPIC_VMIDMT_SMR1_ADDR A:0x67980804
y.create.l HWIO_QPIC_QPIC_VMIDMT_SMR2_ADDR A:0x67980808
y.create.l HWIO_QPIC_QPIC_VMIDMT_SMR3_ADDR A:0x6798080c
y.create.l HWIO_QPIC_QPIC_VMIDMT_SMR4_ADDR A:0x67980810
y.create.l HWIO_QPIC_QPIC_VMIDMT_SMR5_ADDR A:0x67980814
y.create.l HWIO_QPIC_QPIC_VMIDMT_SMR6_ADDR A:0x67980818
y.create.l HWIO_QPIC_QPIC_VMIDMT_SMR7_ADDR A:0x6798081c
y.create.l HWIO_QPIC_EBI2_CHIP_SELECT_CFG0_ADDR A:0x679a6000
y.create.l HWIO_QPIC_EBI2_CFG_ADDR A:0x679a7004
y.create.l HWIO_QPIC_EBI2_ARBITER_CFG_ADDR A:0x679a7030
y.create.l HWIO_QPIC_EBI2_DEBUG_REG_LSB_ADDR A:0x679a4048
y.create.l HWIO_QPIC_EBI2_DEBUG_REG_MSB_ADDR A:0x679a404c
y.create.l HWIO_QPIC_EBI2_DEBUG_SEL_ADDR A:0x679a4050
y.create.l HWIO_QPIC_EBI2_CRC_CFG_ADDR A:0x679a6054
y.create.l HWIO_QPIC_EBI2_CRC_REMINDER_CFG_ADDR A:0x679a6058
y.create.l HWIO_QPIC_EBI2_NAND_ADM_MUX_ADDR A:0x679a605c
y.create.l HWIO_QPIC_EBI2_CLKON_CFG_ADDR A:0x679a7068
y.create.l HWIO_QPIC_EBI2_CORE_CLKON_CFG_ADDR A:0x679a706c
y.create.l HWIO_QPIC_QPIC_LCDC_CTRL_ADDR A:0x679a2000
y.create.l HWIO_QPIC_LCDC_VERSION_ADDR A:0x679a2004
y.create.l HWIO_QPIC_QPIC_LCDC_IRQ_EN_ADDR A:0x679a2008
y.create.l HWIO_QPIC_QPIC_LCDC_IRQ_STTS_ADDR A:0x679a200c
y.create.l HWIO_QPIC_QPIC_LCDC_IRQ_CLR_ADDR A:0x679a2010
y.create.l HWIO_QPIC_QPIC_LCDC_STTS_ADDR A:0x679a2014
y.create.l HWIO_QPIC_QPIC_LCDC_CMD_DATA_CYCLE_CNT_ADDR A:0x679a2018
y.create.l HWIO_QPIC_QPIC_LCDC_CFG0_ADDR A:0x679a2020
y.create.l HWIO_QPIC_QPIC_LCDC_CFG1_ADDR A:0x679a2024
y.create.l HWIO_QPIC_QPIC_LCDC_CFG2_ADDR A:0x679a2028
y.create.l HWIO_QPIC_QPIC_LCDC_RESET_ADDR A:0x679a202c
y.create.l HWIO_QPIC_QPIC_LCD_DEVICE_RESET_ADDR A:0x679a2030
y.create.l HWIO_QPIC_QPIC_LCDC_FIFO_SOF_ADDR A:0x679a2100
y.create.l HWIO_QPIC_QPIC_LCDC_FIFO_DATA_PORT0_ADDR A:0x679a2140
y.create.l HWIO_QPIC_QPIC_LCDC_FIFO_DATA_PORT1_ADDR A:0x679a2144
y.create.l HWIO_QPIC_QPIC_LCDC_FIFO_DATA_PORT2_ADDR A:0x679a2148
y.create.l HWIO_QPIC_QPIC_LCDC_FIFO_DATA_PORT3_ADDR A:0x679a214c
y.create.l HWIO_QPIC_QPIC_LCDC_FIFO_DATA_PORT4_ADDR A:0x679a2150
y.create.l HWIO_QPIC_QPIC_LCDC_FIFO_DATA_PORT5_ADDR A:0x679a2154
y.create.l HWIO_QPIC_QPIC_LCDC_FIFO_DATA_PORT6_ADDR A:0x679a2158
y.create.l HWIO_QPIC_QPIC_LCDC_FIFO_DATA_PORT7_ADDR A:0x679a215c
y.create.l HWIO_QPIC_QPIC_LCDC_FIFO_DATA_PORT8_ADDR A:0x679a2160
y.create.l HWIO_QPIC_QPIC_LCDC_FIFO_DATA_PORT9_ADDR A:0x679a2164
y.create.l HWIO_QPIC_QPIC_LCDC_FIFO_EOF_ADDR A:0x679a2180
y.create.l HWIO_QPIC_LCD_DEVICE_CMD0_ADDR A:0x679a3000
y.create.l HWIO_QPIC_LCD_DEVICE_CMD1_ADDR A:0x679a3004
y.create.l HWIO_QPIC_LCD_DEVICE_CMD2_ADDR A:0x679a3008
y.create.l HWIO_QPIC_LCD_DEVICE_CMD3_ADDR A:0x679a300c
y.create.l HWIO_QPIC_LCD_DEVICE_CMD4_ADDR A:0x679a3010
y.create.l HWIO_QPIC_LCD_DEVICE_CMD5_ADDR A:0x679a3014
y.create.l HWIO_QPIC_LCD_DEVICE_CMD6_ADDR A:0x679a3018
y.create.l HWIO_QPIC_LCD_DEVICE_CMD7_ADDR A:0x679a301c
y.create.l HWIO_QPIC_LCD_DEVICE_CMD8_ADDR A:0x679a3020
y.create.l HWIO_QPIC_LCD_DEVICE_CMD9_ADDR A:0x679a3024
y.create.l HWIO_QPIC_QPIC_VERSION_ADDR A:0x679a4100
y.create.l HWIO_QPIC_QPIC_CTRL_ADDR A:0x679a7104
y.create.l HWIO_QPIC_QPIC_HW_INFO_ADDR A:0x679a4108
y.create.l HWIO_QPIC_QPIC_REG_PERMISSION_ADDR A:0x679a510c
y.create.l HWIO_QPIC_QPIC_DEBUG_ADDR A:0x679a5110
y.create.l HWIO_QPIC_QPIC_HW_GENERICS_ADDR A:0x679a4114
y.create.l HWIO_QPIC_NAND_FLASH_CMD_ADDR A:0x679b0000
y.create.l HWIO_QPIC_NAND_ADDR0_ADDR A:0x679b0004
y.create.l HWIO_QPIC_NAND_ADDR1_ADDR A:0x679b0008
y.create.l HWIO_QPIC_NAND_FLASH_CHIP_SELECT_ADDR A:0x679b000c
y.create.l HWIO_QPIC_NANDC_EXEC_CMD_ADDR A:0x679b0010
y.create.l HWIO_QPIC_NAND_FLASH_STATUS_ADDR A:0x679b0014
y.create.l HWIO_QPIC_NANDC_BUFFER_STATUS_ADDR A:0x679b0018
y.create.l HWIO_QPIC_NAND_DEV0_CFG0_ADDR A:0x679b0020
y.create.l HWIO_QPIC_NAND_DEV1_CFG0_ADDR A:0x679b0030
y.create.l HWIO_QPIC_NAND_DEV0_CFG1_ADDR A:0x679b0024
y.create.l HWIO_QPIC_NAND_DEV1_CFG1_ADDR A:0x679b0034
y.create.l HWIO_QPIC_NAND_DEV0_ECC_CFG_ADDR A:0x679b0028
y.create.l HWIO_QPIC_NAND_DEV1_ECC_CFG_ADDR A:0x679b602c
y.create.l HWIO_QPIC_NAND_FLASH_READ_ID_ADDR A:0x679b0040
y.create.l HWIO_QPIC_NAND_FLASH_READ_ID2_ADDR A:0x679b0048
y.create.l HWIO_QPIC_NAND_FLASH_READ_STATUS_ADDR A:0x679b0044
y.create.l HWIO_QPIC_NAND_FLASH_CONFIG_DATA_ADDR A:0x679b6050
y.create.l HWIO_QPIC_NAND_FLASH_CONFIG_ADDR A:0x679b6054
y.create.l HWIO_QPIC_NAND_FLASH_CONFIG_MODE_ADDR A:0x679b6058
y.create.l HWIO_QPIC_NAND_FLASH_CONFIG_STATUS_ADDR A:0x679b6060
y.create.l HWIO_QPIC_FLASH_MACRO1_REG_ADDR A:0x679b6064
y.create.l HWIO_QPIC_HSDDR_NAND_CFG_ADDR A:0x679b6068
y.create.l HWIO_QPIC_FLASH_XFR_STEP1_ADDR A:0x679b7070
y.create.l HWIO_QPIC_FLASH_XFR_STEP2_ADDR A:0x679b7074
y.create.l HWIO_QPIC_FLASH_XFR_STEP3_ADDR A:0x679b7078
y.create.l HWIO_QPIC_FLASH_XFR_STEP4_ADDR A:0x679b707c
y.create.l HWIO_QPIC_FLASH_XFR_STEP5_ADDR A:0x679b7080
y.create.l HWIO_QPIC_FLASH_XFR_STEP6_ADDR A:0x679b7084
y.create.l HWIO_QPIC_FLASH_XFR_STEP7_ADDR A:0x679b7088
y.create.l HWIO_QPIC_NAND_GENP_REG0_ADDR A:0x679b6090
y.create.l HWIO_QPIC_NAND_GENP_REG1_ADDR A:0x679b6094
y.create.l HWIO_QPIC_NAND_GENP_REG2_ADDR A:0x679b6098
y.create.l HWIO_QPIC_NAND_GENP_REG3_ADDR A:0x679b609c
y.create.l HWIO_QPIC_FLASH_DEV_CMD0_ADDR A:0x679b70a0
y.create.l HWIO_QPIC_FLASH_DEV_CMD1_ADDR A:0x679b70a4
y.create.l HWIO_QPIC_FLASH_DEV_CMD2_ADDR A:0x679b70a8
y.create.l HWIO_QPIC_FLASH_DEV_CMD_VLD_ADDR A:0x679b70ac
y.create.l HWIO_QPIC_NAND_ADDR2_ADDR A:0x679b60c0
y.create.l HWIO_QPIC_NAND_ADDR3_ADDR A:0x679b60c4
y.create.l HWIO_QPIC_NAND_ADDR4_ADDR A:0x679b60c8
y.create.l HWIO_QPIC_NAND_ADDR5_ADDR A:0x679b60cc
y.create.l HWIO_QPIC_FLASH_DEV_CMD3_ADDR A:0x679b70d0
y.create.l HWIO_QPIC_FLASH_DEV_CMD4_ADDR A:0x679b70d4
y.create.l HWIO_QPIC_FLASH_DEV_CMD5_ADDR A:0x679b70d8
y.create.l HWIO_QPIC_FLASH_DEV_CMD6_ADDR A:0x679b70dc
y.create.l HWIO_QPIC_NAND_ADDR6_ADDR A:0x679b60e4
y.create.l HWIO_QPIC_NAND_ERASED_CW_DETECT_CFG_ADDR A:0x679b00e8
y.create.l HWIO_QPIC_NAND_ERASED_CW_DETECT_STATUS_ADDR A:0x679b00ec
y.create.l HWIO_QPIC_EBI2_ECC_BUF_CFG_ADDR A:0x679b00f0
y.create.l HWIO_QPIC_NANDC_DBG_CFG_ADDR A:0x679b40f4
y.create.l HWIO_QPIC_NANDC_HW_PROFILE_CFG_ADDR A:0x679b40f8
y.create.l HWIO_QPIC_FLASH_BUFF0_ACC_ADDR A:0x679b0100
y.create.l HWIO_QPIC_FLASH_BUFF1_ACC_ADDR A:0x679b0104
y.create.l HWIO_QPIC_FLASH_BUFF2_ACC_ADDR A:0x679b0108
y.create.l HWIO_QPIC_FLASH_BUFF3_ACC_ADDR A:0x679b010c
y.create.l HWIO_QPIC_FLASH_BUFF4_ACC_ADDR A:0x679b0110
y.create.l HWIO_QPIC_FLASH_BUFF5_ACC_ADDR A:0x679b0114
y.create.l HWIO_QPIC_FLASH_BUFF6_ACC_ADDR A:0x679b0118
y.create.l HWIO_QPIC_FLASH_BUFF7_ACC_ADDR A:0x679b011c
y.create.l HWIO_QPIC_FLASH_BUFF8_ACC_ADDR A:0x679b0120
y.create.l HWIO_QPIC_FLASH_BUFF9_ACC_ADDR A:0x679b0124
y.create.l HWIO_QPIC_NAND_CTRL_ADDR A:0x679b0f00
y.create.l HWIO_QPIC_NAND_STATUS_ADDR A:0x679b4f04
y.create.l HWIO_QPIC_NAND_VERSION_ADDR A:0x679b4f08
y.create.l HWIO_QPIC_NAND_MPU_BYPASS_ADDR A:0x679b5f44
y.create.l HWIO_QPIC_NAND_DEBUG_ADDR A:0x679b5f0c
y.create.l HWIO_QPIC_NAND_IRQ_STTS_ADDR A:0x679b0f10
y.create.l HWIO_QPIC_NAND_IRQ_CLR_ADDR A:0x679b0f14
y.create.l HWIO_QPIC_NAND_IRQ_EN_ADDR A:0x679b0f18
y.create.l HWIO_QPIC_NAND_MUTEX_ADDR A:0x679b0f1c
y.create.l HWIO_QPIC_NAND_CONFIG_BITS_ADDR A:0x679b7f40
y.create.l HWIO_QPIC_NAND_READ_LOCATION_0_ADDR A:0x679b0f20
y.create.l HWIO_QPIC_NAND_READ_LOCATION_1_ADDR A:0x679b0f24
y.create.l HWIO_QPIC_NAND_READ_LOCATION_2_ADDR A:0x679b0f28
y.create.l HWIO_QPIC_NAND_READ_LOCATION_3_ADDR A:0x679b0f2c
y.create.l HWIO_QPIC_NAND_READ_LOCATION_4_ADDR A:0x679b0f30
y.create.l HWIO_QPIC_NAND_TEST_BUS_LSB_ADDR A:0x679b4f48
y.create.l HWIO_QPIC_NAND_TEST_BUS_MSB_ADDR A:0x679b4f4c
y.create.l HWIO_QPIC_NAND_OP_DONE_CNT_ADDR A:0x679b5f50
y.create.l HWIO_QPIC_NAND_ERR_RESP_TIME_OUT_ADDR A:0x679b7f54
y.create.l HWIO_QPIC_QPIC_MPU_XPU_SCR_ADDR A:0x679b1000
y.create.l HWIO_QPIC_QPIC_MPU_XPU_SWDR_ADDR A:0x679b1004
y.create.l HWIO_QPIC_QPIC_MPU_XPU_PRTN_RACR_SSHADOW_ADDR A:0x679b1008
y.create.l HWIO_QPIC_QPIC_MPU_XPU_PRTN_WACR_SSHADOW_ADDR A:0x679b100c
y.create.l HWIO_QPIC_QPIC_MPU_XPU_PRTN_START_SSHADOW0_ADDR A:0x679b1010
y.create.l HWIO_QPIC_QPIC_MPU_XPU_PRTN_START_SSHADOW1_ADDR A:0x679b1014
y.create.l HWIO_QPIC_QPIC_MPU_XPU_PRTN_END_SSHADOW0_ADDR A:0x679b1018
y.create.l HWIO_QPIC_QPIC_MPU_XPU_PRTN_END_SSHADOW1_ADDR A:0x679b101c
y.create.l HWIO_QPIC_QPIC_MPU_XPU_SEAR0_ADDR A:0x679b1040
y.create.l HWIO_QPIC_QPIC_MPU_XPU_SEAR1_ADDR A:0x679b1044
y.create.l HWIO_QPIC_QPIC_MPU_XPU_SESR_ADDR A:0x679b1048
y.create.l HWIO_QPIC_QPIC_MPU_XPU_SESRRESTORE_ADDR A:0x679b104c
y.create.l HWIO_QPIC_QPIC_MPU_XPU_SESYNR0_ADDR A:0x679b1050
y.create.l HWIO_QPIC_QPIC_MPU_XPU_SESYNR1_ADDR A:0x679b1054
y.create.l HWIO_QPIC_QPIC_MPU_XPU_SESYNR2_ADDR A:0x679b1058
y.create.l HWIO_QPIC_QPIC_MPU_XPU_MCR_ADDR A:0x679b1100
y.create.l HWIO_QPIC_QPIC_MPU_XPU_MEAR0_ADDR A:0x679b1140
y.create.l HWIO_QPIC_QPIC_MPU_XPU_MEAR1_ADDR A:0x679b1144
y.create.l HWIO_QPIC_QPIC_MPU_XPU_MESR_ADDR A:0x679b1148
y.create.l HWIO_QPIC_QPIC_MPU_XPU_MESRRESTORE_ADDR A:0x679b114c
y.create.l HWIO_QPIC_QPIC_MPU_XPU_MESYNR0_ADDR A:0x679b1150
y.create.l HWIO_QPIC_QPIC_MPU_XPU_MESYNR1_ADDR A:0x679b1154
y.create.l HWIO_QPIC_QPIC_MPU_XPU_MESYNR2_ADDR A:0x679b1158
y.create.l HWIO_QPIC_QPIC_MPU_XPU_CR_ADDR A:0x679b1080
y.create.l HWIO_QPIC_QPIC_MPU_XPU_PRTN_RACR_SHADOW_ADDR A:0x679b1088
y.create.l HWIO_QPIC_QPIC_MPU_XPU_PRTN_WACR_SHADOW_ADDR A:0x679b108c
y.create.l HWIO_QPIC_QPIC_MPU_XPU_PRTN_START_SHADOW0_ADDR A:0x679b1090
y.create.l HWIO_QPIC_QPIC_MPU_XPU_PRTN_START_SHADOW1_ADDR A:0x679b1094
y.create.l HWIO_QPIC_QPIC_MPU_XPU_PRTN_END_SHADOW0_ADDR A:0x679b1098
y.create.l HWIO_QPIC_QPIC_MPU_XPU_PRTN_END_SHADOW1_ADDR A:0x679b109c
y.create.l HWIO_QPIC_QPIC_MPU_XPU_RPU_ACR0_ADDR A:0x679b10a0
y.create.l HWIO_QPIC_QPIC_MPU_XPU_EAR0_ADDR A:0x679b10c0
y.create.l HWIO_QPIC_QPIC_MPU_XPU_EAR1_ADDR A:0x679b10c4
y.create.l HWIO_QPIC_QPIC_MPU_XPU_ESR_ADDR A:0x679b10c8
y.create.l HWIO_QPIC_QPIC_MPU_XPU_ESRRESTORE_ADDR A:0x679b10cc
y.create.l HWIO_QPIC_QPIC_MPU_XPU_ESYNR0_ADDR A:0x679b10d0
y.create.l HWIO_QPIC_QPIC_MPU_XPU_ESYNR1_ADDR A:0x679b10d4
y.create.l HWIO_QPIC_QPIC_MPU_XPU_ESYNR2_ADDR A:0x679b10d8
y.create.l HWIO_QPIC_QPIC_MPU_XPU_UMR_RACR_ADDR A:0x679b10e0
y.create.l HWIO_QPIC_QPIC_MPU_XPU_UMR_WACR_ADDR A:0x679b10e4
y.create.l HWIO_QPIC_QPIC_MPU_XPU_UMR_CNTL_ADDR A:0x679b10f0
y.create.l HWIO_QPIC_QPIC_MPU_XPU_IDR0_ADDR A:0x679b1074
y.create.l HWIO_QPIC_QPIC_MPU_XPU_IDR1_ADDR A:0x679b1078
y.create.l HWIO_QPIC_QPIC_MPU_XPU_REV_ADDR A:0x679b107c
y.create.l HWIO_QPIC_QPIC_MPU_XPU_PRT0_RACR0_ADDR A:0x679b1200
y.create.l HWIO_QPIC_QPIC_MPU_XPU_PRT1_RACR0_ADDR A:0x679b1280
y.create.l HWIO_QPIC_QPIC_MPU_XPU_PRT2_RACR0_ADDR A:0x679b1300
y.create.l HWIO_QPIC_QPIC_MPU_XPU_PRT3_RACR0_ADDR A:0x679b1380
y.create.l HWIO_QPIC_QPIC_MPU_XPU_PRT4_RACR0_ADDR A:0x679b1400
y.create.l HWIO_QPIC_QPIC_MPU_XPU_PRT5_RACR0_ADDR A:0x679b1480
y.create.l HWIO_QPIC_QPIC_MPU_XPU_PRT6_RACR0_ADDR A:0x679b1500
y.create.l HWIO_QPIC_QPIC_MPU_XPU_PRT7_RACR0_ADDR A:0x679b1580
y.create.l HWIO_QPIC_QPIC_MPU_XPU_PRT0_WACR0_ADDR A:0x679b1220
y.create.l HWIO_QPIC_QPIC_MPU_XPU_PRT1_WACR0_ADDR A:0x679b12a0
y.create.l HWIO_QPIC_QPIC_MPU_XPU_PRT2_WACR0_ADDR A:0x679b1320
y.create.l HWIO_QPIC_QPIC_MPU_XPU_PRT3_WACR0_ADDR A:0x679b13a0
y.create.l HWIO_QPIC_QPIC_MPU_XPU_PRT4_WACR0_ADDR A:0x679b1420
y.create.l HWIO_QPIC_QPIC_MPU_XPU_PRT5_WACR0_ADDR A:0x679b14a0
y.create.l HWIO_QPIC_QPIC_MPU_XPU_PRT6_WACR0_ADDR A:0x679b1520
y.create.l HWIO_QPIC_QPIC_MPU_XPU_PRT7_WACR0_ADDR A:0x679b15a0
y.create.l HWIO_QPIC_QPIC_MPU_XPU_PRT0_START0_ADDR A:0x679b1240
y.create.l HWIO_QPIC_QPIC_MPU_XPU_PRT1_START0_ADDR A:0x679b12c0
y.create.l HWIO_QPIC_QPIC_MPU_XPU_PRT2_START0_ADDR A:0x679b1340
y.create.l HWIO_QPIC_QPIC_MPU_XPU_PRT3_START0_ADDR A:0x679b13c0
y.create.l HWIO_QPIC_QPIC_MPU_XPU_PRT4_START0_ADDR A:0x679b1440
y.create.l HWIO_QPIC_QPIC_MPU_XPU_PRT5_START0_ADDR A:0x679b14c0
y.create.l HWIO_QPIC_QPIC_MPU_XPU_PRT6_START0_ADDR A:0x679b1540
y.create.l HWIO_QPIC_QPIC_MPU_XPU_PRT7_START0_ADDR A:0x679b15c0
y.create.l HWIO_QPIC_QPIC_MPU_XPU_PRT0_START1_ADDR A:0x679b1244
y.create.l HWIO_QPIC_QPIC_MPU_XPU_PRT1_START1_ADDR A:0x679b12c4
y.create.l HWIO_QPIC_QPIC_MPU_XPU_PRT2_START1_ADDR A:0x679b1344
y.create.l HWIO_QPIC_QPIC_MPU_XPU_PRT3_START1_ADDR A:0x679b13c4
y.create.l HWIO_QPIC_QPIC_MPU_XPU_PRT4_START1_ADDR A:0x679b1444
y.create.l HWIO_QPIC_QPIC_MPU_XPU_PRT5_START1_ADDR A:0x679b14c4
y.create.l HWIO_QPIC_QPIC_MPU_XPU_PRT6_START1_ADDR A:0x679b1544
y.create.l HWIO_QPIC_QPIC_MPU_XPU_PRT7_START1_ADDR A:0x679b15c4
y.create.l HWIO_QPIC_QPIC_MPU_XPU_PRT0_END0_ADDR A:0x679b1248
y.create.l HWIO_QPIC_QPIC_MPU_XPU_PRT1_END0_ADDR A:0x679b12c8
y.create.l HWIO_QPIC_QPIC_MPU_XPU_PRT2_END0_ADDR A:0x679b1348
y.create.l HWIO_QPIC_QPIC_MPU_XPU_PRT3_END0_ADDR A:0x679b13c8
y.create.l HWIO_QPIC_QPIC_MPU_XPU_PRT4_END0_ADDR A:0x679b1448
y.create.l HWIO_QPIC_QPIC_MPU_XPU_PRT5_END0_ADDR A:0x679b14c8
y.create.l HWIO_QPIC_QPIC_MPU_XPU_PRT6_END0_ADDR A:0x679b1548
y.create.l HWIO_QPIC_QPIC_MPU_XPU_PRT7_END0_ADDR A:0x679b15c8
y.create.l HWIO_QPIC_QPIC_MPU_XPU_PRT0_END1_ADDR A:0x679b124c
y.create.l HWIO_QPIC_QPIC_MPU_XPU_PRT1_END1_ADDR A:0x679b12cc
y.create.l HWIO_QPIC_QPIC_MPU_XPU_PRT2_END1_ADDR A:0x679b134c
y.create.l HWIO_QPIC_QPIC_MPU_XPU_PRT3_END1_ADDR A:0x679b13cc
y.create.l HWIO_QPIC_QPIC_MPU_XPU_PRT4_END1_ADDR A:0x679b144c
y.create.l HWIO_QPIC_QPIC_MPU_XPU_PRT5_END1_ADDR A:0x679b14cc
y.create.l HWIO_QPIC_QPIC_MPU_XPU_PRT6_END1_ADDR A:0x679b154c
y.create.l HWIO_QPIC_QPIC_MPU_XPU_PRT7_END1_ADDR A:0x679b15cc
y.create.l HWIO_QPIC_QPIC_MPU_XPU_PRT0_SCR_ADDR A:0x679b1250
y.create.l HWIO_QPIC_QPIC_MPU_XPU_PRT1_SCR_ADDR A:0x679b12d0
y.create.l HWIO_QPIC_QPIC_MPU_XPU_PRT2_SCR_ADDR A:0x679b1350
y.create.l HWIO_QPIC_QPIC_MPU_XPU_PRT3_SCR_ADDR A:0x679b13d0
y.create.l HWIO_QPIC_QPIC_MPU_XPU_PRT4_SCR_ADDR A:0x679b1450
y.create.l HWIO_QPIC_QPIC_MPU_XPU_PRT5_SCR_ADDR A:0x679b14d0
y.create.l HWIO_QPIC_QPIC_MPU_XPU_PRT6_SCR_ADDR A:0x679b1550
y.create.l HWIO_QPIC_QPIC_MPU_XPU_PRT7_SCR_ADDR A:0x679b15d0
y.create.l HWIO_QPIC_QPIC_MPU_XPU_PRT0_MCR_ADDR A:0x679b1254
y.create.l HWIO_QPIC_QPIC_MPU_XPU_PRT1_MCR_ADDR A:0x679b12d4
y.create.l HWIO_QPIC_QPIC_MPU_XPU_PRT2_MCR_ADDR A:0x679b1354
y.create.l HWIO_QPIC_QPIC_MPU_XPU_PRT3_MCR_ADDR A:0x679b13d4
y.create.l HWIO_QPIC_QPIC_MPU_XPU_PRT4_MCR_ADDR A:0x679b1454
y.create.l HWIO_QPIC_QPIC_MPU_XPU_PRT5_MCR_ADDR A:0x679b14d4
y.create.l HWIO_QPIC_QPIC_MPU_XPU_PRT6_MCR_ADDR A:0x679b1554
y.create.l HWIO_QPIC_QPIC_MPU_XPU_PRT7_MCR_ADDR A:0x679b15d4
y.create.l HWIO_QPIC_QPIC_MPU_XPU_PRT0_CNTL0_ADDR A:0x679b1258
y.create.l HWIO_QPIC_QPIC_MPU_XPU_PRT1_CNTL0_ADDR A:0x679b12d8
y.create.l HWIO_QPIC_QPIC_MPU_XPU_PRT2_CNTL0_ADDR A:0x679b1358
y.create.l HWIO_QPIC_QPIC_MPU_XPU_PRT3_CNTL0_ADDR A:0x679b13d8
y.create.l HWIO_QPIC_QPIC_MPU_XPU_PRT4_CNTL0_ADDR A:0x679b1458
y.create.l HWIO_QPIC_QPIC_MPU_XPU_PRT5_CNTL0_ADDR A:0x679b14d8
y.create.l HWIO_QPIC_QPIC_MPU_XPU_PRT6_CNTL0_ADDR A:0x679b1558
y.create.l HWIO_QPIC_QPIC_MPU_XPU_PRT7_CNTL0_ADDR A:0x679b15d8
y.create.l HWIO_QPIC_QPIC_MPU_XPU_PRT0_CNTL1_ADDR A:0x679b125c
y.create.l HWIO_QPIC_QPIC_MPU_XPU_PRT1_CNTL1_ADDR A:0x679b12dc
y.create.l HWIO_QPIC_QPIC_MPU_XPU_PRT2_CNTL1_ADDR A:0x679b135c
y.create.l HWIO_QPIC_QPIC_MPU_XPU_PRT3_CNTL1_ADDR A:0x679b13dc
y.create.l HWIO_QPIC_QPIC_MPU_XPU_PRT4_CNTL1_ADDR A:0x679b145c
y.create.l HWIO_QPIC_QPIC_MPU_XPU_PRT5_CNTL1_ADDR A:0x679b14dc
y.create.l HWIO_QPIC_QPIC_MPU_XPU_PRT6_CNTL1_ADDR A:0x679b155c
y.create.l HWIO_QPIC_QPIC_MPU_XPU_PRT7_CNTL1_ADDR A:0x679b15dc
y.create.l HWIO_RBCPR_VERSION_ADDR A:0x60048000
y.create.l HWIO_RBCPR_SENSOR_MASK0_ADDR A:0x60048020
y.create.l HWIO_RBCPR_SENSOR_MASK1_ADDR A:0x60048024
y.create.l HWIO_RBCPR_SENSOR_MASK2_ADDR A:0x60048028
y.create.l HWIO_RBCPR_SENSOR_MASK3_ADDR A:0x6004802c
y.create.l HWIO_RBCPR_SENSOR_BYPASS0_ADDR A:0x60048030
y.create.l HWIO_RBCPR_SENSOR_BYPASS1_ADDR A:0x60048034
y.create.l HWIO_RBCPR_SENSOR_BYPASS2_ADDR A:0x60048038
y.create.l HWIO_RBCPR_SENSOR_BYPASS3_ADDR A:0x6004803c
y.create.l HWIO_RBIF_PMIC_ADDR_ADDR A:0x60048040
y.create.l HWIO_RBCPR_TIMER_INTERVAL_ADDR A:0x60048044
y.create.l HWIO_RBIF_LIMIT_ADDR A:0x60048048
y.create.l HWIO_RBIF_TIMER_ADJUST_ADDR A:0x6004804c
y.create.l HWIO_RBCPR_GCNT_TARGET0_ADDR A:0x60048060
y.create.l HWIO_RBCPR_GCNT_TARGET1_ADDR A:0x60048064
y.create.l HWIO_RBCPR_GCNT_TARGET2_ADDR A:0x60048068
y.create.l HWIO_RBCPR_GCNT_TARGET3_ADDR A:0x6004806c
y.create.l HWIO_RBCPR_GCNT_TARGET4_ADDR A:0x60048070
y.create.l HWIO_RBCPR_GCNT_TARGET5_ADDR A:0x60048074
y.create.l HWIO_RBCPR_GCNT_TARGET6_ADDR A:0x60048078
y.create.l HWIO_RBCPR_GCNT_TARGET7_ADDR A:0x6004807c
y.create.l HWIO_RBCPR_STEP_QUOT_ADDR A:0x60048080
y.create.l HWIO_RBCPR_CTL_ADDR A:0x60048090
y.create.l HWIO_RBIF_SW_VLEVEL_ADDR A:0x60048094
y.create.l HWIO_RBIF_CONT_ACK_CMD_ADDR A:0x60048098
y.create.l HWIO_RBIF_CONT_NACK_CMD_ADDR A:0x6004809c
y.create.l HWIO_RBCPR_RESULT_0_ADDR A:0x600480a0
y.create.l HWIO_RBCPR_RESULT_1_ADDR A:0x600480a4
y.create.l HWIO_RBIF_IRQ_EN_0_ADDR A:0x60048100
y.create.l HWIO_RBIF_IRQ_EN_1_ADDR A:0x60048104
y.create.l HWIO_RBIF_IRQ_EN_2_ADDR A:0x60048108
y.create.l HWIO_RBIF_IRQ_CLEAR_ADDR A:0x60048110
y.create.l HWIO_RBIF_IRQ_STATUS_ADDR A:0x60048114
y.create.l HWIO_RBCPR_QUOT_AVG_ADDR A:0x60048118
y.create.l HWIO_RBCPR_DEBUG0_ADDR A:0x6004811c
y.create.l HWIO_RBCPR_DEBUG1_ADDR A:0x60048120
y.create.l HWIO_RBCPR_DEBUG2_ADDR A:0x60048124
y.create.l HWIO_RBCPR_BIST_MINMAX_ADDR A:0x60048128
y.create.l HWIO_RBCPR_BIST_RESULT_ADDR A:0x6004812c
y.create.l HWIO_RBCPR_BIST_FAIL_MAP0_ADDR A:0x60048130
y.create.l HWIO_RBCPR_BIST_FAIL_MAP1_ADDR A:0x60048134
y.create.l HWIO_RBCPR_BIST_FAIL_MAP2_ADDR A:0x60048138
y.create.l HWIO_RBCPR_BIST_FAIL_MAP3_ADDR A:0x6004813c
y.create.l HWIO_RBCPR_LOG_0_ADDR A:0x60048140
y.create.l HWIO_RBCPR_LOG_1_ADDR A:0x60048144
y.create.l HWIO_RBCPR_LOG_2_ADDR A:0x60048148
y.create.l HWIO_RBCPR_LOG_3_ADDR A:0x6004814c
y.create.l HWIO_RBCPR_LOG_4_ADDR A:0x60048150
y.create.l HWIO_RBCPR_LOG_5_ADDR A:0x60048154
y.create.l HWIO_RBCPR_LOG_6_ADDR A:0x60048158
y.create.l HWIO_RBCPR_LOG_7_ADDR A:0x6004815c
y.create.l HWIO_RBCPR_HTOL_AGE_ADDR A:0x60048160
y.create.l HWIO_RPM_HW_VERSION_ADDR A:0x80000
y.create.l HWIO_RPM_WFI_CONFIG_ADDR A:0x80004
y.create.l HWIO_RPM_TIMERS_CLK_OFF_CTL_ADDR A:0x80008
y.create.l HWIO_RPM_IPC_ADDR A:0x8000c
y.create.l HWIO_RPM_GPO_WDATA_ADDR A:0x80010
y.create.l HWIO_RPM_GPO_WDSET_ADDR A:0x80014
y.create.l HWIO_RPM_GPO_WDCLR_ADDR A:0x80018
y.create.l HWIO_RPM_SLAVES_CLK_GATING_ADDR A:0x8001c
y.create.l HWIO_RPM_INTR_POLARITY_0_ADDR A:0x80030
y.create.l HWIO_RPM_INTR_POLARITY_1_ADDR A:0x80034
y.create.l HWIO_RPM_INTR_EDG_LVL_0_ADDR A:0x80038
y.create.l HWIO_RPM_INTR_EDG_LVL_1_ADDR A:0x8003c
y.create.l HWIO_RPM_WDOG_RESET_ADDR A:0x80040
y.create.l HWIO_RPM_WDOG_CTRL_ADDR A:0x80044
y.create.l HWIO_RPM_WDOG_STATUS_ADDR A:0x80048
y.create.l HWIO_RPM_WDOG_BARK_TIME_ADDR A:0x8004c
y.create.l HWIO_RPM_WDOG_BITE_TIME_ADDR A:0x80050
y.create.l HWIO_RPM_WDOG_TEST_LOAD_ADDR A:0x80054
y.create.l HWIO_RPM_WDOG_TEST_ADDR A:0x80058
y.create.l HWIO_RPM_TEST_BUS_SEL_ADDR A:0x8005c
y.create.l HWIO_RPM_SPARE_REG0_ADDR A:0x80060
y.create.l HWIO_RPM_SPARE_REG1_ADDR A:0x80064
y.create.l HWIO_RPM_SPARE_REG2_ADDR A:0x80068
y.create.l HWIO_RPM_SPARE_REG3_ADDR A:0x8006c
y.create.l HWIO_RPM_PAGE_SELECT_ADDR A:0x80070
y.create.l HWIO_RPM_QTMR_AC_CNTFRQ_ADDR A:0x82000
y.create.l HWIO_RPM_QTMR_AC_CNTSR_ADDR A:0x82004
y.create.l HWIO_RPM_QTMR_AC_CNTTID_ADDR A:0x82008
y.create.l HWIO_RPM_QTMR_AC_CNTACR_0_ADDR A:0x82040
y.create.l HWIO_RPM_QTMR_AC_CNTACR_1_ADDR A:0x82044
y.create.l HWIO_RPM_QTMR_AC_CNTVOFF_LO_0_ADDR A:0x82080
y.create.l HWIO_RPM_QTMR_AC_CNTVOFF_LO_1_ADDR A:0x82088
y.create.l HWIO_RPM_QTMR_AC_CNTVOFF_HI_0_ADDR A:0x82084
y.create.l HWIO_RPM_QTMR_AC_CNTVOFF_HI_1_ADDR A:0x8208c
y.create.l HWIO_RPM_QTMR_AC_CFG_ADDR A:0x82fc0
y.create.l HWIO_RPM_QTMR_AC_VERSION_ADDR A:0x82fd0
y.create.l HWIO_RPM_F0_QTMR_V1_CNTPCT_LO_ADDR A:0x83000
y.create.l HWIO_RPM_F0_QTMR_V1_CNTPCT_HI_ADDR A:0x83004
y.create.l HWIO_RPM_F0_QTMR_V1_CNTVCT_LO_ADDR A:0x83008
y.create.l HWIO_RPM_F0_QTMR_V1_CNTVCT_HI_ADDR A:0x8300c
y.create.l HWIO_RPM_F0_QTMR_V1_CNTFRQ_ADDR A:0x83010
y.create.l HWIO_RPM_F0_QTMR_V1_CNTPL0ACR_ADDR A:0x83014
y.create.l HWIO_RPM_F0_QTMR_V1_CNTVOFF_LO_ADDR A:0x83018
y.create.l HWIO_RPM_F0_QTMR_V1_CNTVOFF_HI_ADDR A:0x8301c
y.create.l HWIO_RPM_F0_QTMR_V1_CNTP_CVAL_LO_ADDR A:0x83020
y.create.l HWIO_RPM_F0_QTMR_V1_CNTP_CVAL_HI_ADDR A:0x83024
y.create.l HWIO_RPM_F0_QTMR_V1_CNTP_TVAL_ADDR A:0x83028
y.create.l HWIO_RPM_F0_QTMR_V1_CNTP_CTL_ADDR A:0x8302c
y.create.l HWIO_RPM_F0_QTMR_V1_CNTV_CVAL_LO_ADDR A:0x83030
y.create.l HWIO_RPM_F0_QTMR_V1_CNTV_CVAL_HI_ADDR A:0x83034
y.create.l HWIO_RPM_F0_QTMR_V1_CNTV_TVAL_ADDR A:0x83038
y.create.l HWIO_RPM_F0_QTMR_V1_CNTV_CTL_ADDR A:0x8303c
y.create.l HWIO_RPM_F0_QTMR_V1_VERSION_ADDR A:0x83fd0
y.create.l HWIO_RPM_F1_QTMR_V1_CNTPCT_LO_ADDR A:0x84000
y.create.l HWIO_RPM_F1_QTMR_V1_CNTPCT_HI_ADDR A:0x84004
y.create.l HWIO_RPM_F1_QTMR_V1_CNTVCT_LO_ADDR A:0x84008
y.create.l HWIO_RPM_F1_QTMR_V1_CNTVCT_HI_ADDR A:0x8400c
y.create.l HWIO_RPM_F1_QTMR_V1_CNTFRQ_ADDR A:0x84010
y.create.l HWIO_RPM_F1_QTMR_V1_CNTPL0ACR_ADDR A:0x84014
y.create.l HWIO_RPM_F1_QTMR_V1_CNTVOFF_LO_ADDR A:0x84018
y.create.l HWIO_RPM_F1_QTMR_V1_CNTVOFF_HI_ADDR A:0x8401c
y.create.l HWIO_RPM_F1_QTMR_V1_CNTP_CVAL_LO_ADDR A:0x84020
y.create.l HWIO_RPM_F1_QTMR_V1_CNTP_CVAL_HI_ADDR A:0x84024
y.create.l HWIO_RPM_F1_QTMR_V1_CNTP_TVAL_ADDR A:0x84028
y.create.l HWIO_RPM_F1_QTMR_V1_CNTP_CTL_ADDR A:0x8402c
y.create.l HWIO_RPM_F1_QTMR_V1_CNTV_CVAL_LO_ADDR A:0x84030
y.create.l HWIO_RPM_F1_QTMR_V1_CNTV_CVAL_HI_ADDR A:0x84034
y.create.l HWIO_RPM_F1_QTMR_V1_CNTV_TVAL_ADDR A:0x84038
y.create.l HWIO_RPM_F1_QTMR_V1_CNTV_CTL_ADDR A:0x8403c
y.create.l HWIO_RPM_F1_QTMR_V1_VERSION_ADDR A:0x84fd0
y.create.l HWIO_RPM_APU_XPU_SCR_ADDR A:0x87000
y.create.l HWIO_RPM_APU_XPU_SWDR_ADDR A:0x87004
y.create.l HWIO_RPM_APU_XPU_SEAR0_ADDR A:0x87040
y.create.l HWIO_RPM_APU_XPU_SESR_ADDR A:0x87048
y.create.l HWIO_RPM_APU_XPU_SESRRESTORE_ADDR A:0x8704c
y.create.l HWIO_RPM_APU_XPU_SESYNR0_ADDR A:0x87050
y.create.l HWIO_RPM_APU_XPU_SESYNR1_ADDR A:0x87054
y.create.l HWIO_RPM_APU_XPU_SESYNR2_ADDR A:0x87058
y.create.l HWIO_RPM_APU_XPU_MCR_ADDR A:0x87100
y.create.l HWIO_RPM_APU_XPU_MEAR0_ADDR A:0x87140
y.create.l HWIO_RPM_APU_XPU_MESR_ADDR A:0x87148
y.create.l HWIO_RPM_APU_XPU_MESRRESTORE_ADDR A:0x8714c
y.create.l HWIO_RPM_APU_XPU_MESYNR0_ADDR A:0x87150
y.create.l HWIO_RPM_APU_XPU_MESYNR1_ADDR A:0x87154
y.create.l HWIO_RPM_APU_XPU_MESYNR2_ADDR A:0x87158
y.create.l HWIO_RPM_APU_XPU_CR_ADDR A:0x87080
y.create.l HWIO_RPM_APU_XPU_RPU_ACR0_ADDR A:0x870a0
y.create.l HWIO_RPM_APU_XPU_EAR0_ADDR A:0x870c0
y.create.l HWIO_RPM_APU_XPU_ESR_ADDR A:0x870c8
y.create.l HWIO_RPM_APU_XPU_ESRRESTORE_ADDR A:0x870cc
y.create.l HWIO_RPM_APU_XPU_ESYNR0_ADDR A:0x870d0
y.create.l HWIO_RPM_APU_XPU_ESYNR1_ADDR A:0x870d4
y.create.l HWIO_RPM_APU_XPU_ESYNR2_ADDR A:0x870d8
y.create.l HWIO_RPM_APU_XPU_IDR0_ADDR A:0x87074
y.create.l HWIO_RPM_APU_XPU_IDR1_ADDR A:0x87078
y.create.l HWIO_RPM_APU_XPU_REV_ADDR A:0x8707c
y.create.l HWIO_RPM_APU_XPU_RG0_RACR0_ADDR A:0x87200
y.create.l HWIO_RPM_APU_XPU_RG1_RACR0_ADDR A:0x87280
y.create.l HWIO_RPM_APU_XPU_RG0_WACR0_ADDR A:0x87220
y.create.l HWIO_RPM_APU_XPU_RG1_WACR0_ADDR A:0x872a0
y.create.l HWIO_RPM_APU_XPU_RG0_SCR_ADDR A:0x87250
y.create.l HWIO_RPM_APU_XPU_RG1_SCR_ADDR A:0x872d0
y.create.l HWIO_RPM_APU_XPU_RG0_MCR_ADDR A:0x87254
y.create.l HWIO_RPM_APU_XPU_RG1_MCR_ADDR A:0x872d4
y.create.l HWIO_RPM_VMIDMT_SCR0_ADDR A:0x88000
y.create.l HWIO_RPM_VMIDMT_SCR1_ADDR A:0x88004
y.create.l HWIO_RPM_VMIDMT_SCR2_ADDR A:0x88008
y.create.l HWIO_RPM_VMIDMT_SACR_ADDR A:0x88010
y.create.l HWIO_RPM_VMIDMT_SIDR0_ADDR A:0x88020
y.create.l HWIO_RPM_VMIDMT_SIDR1_ADDR A:0x88024
y.create.l HWIO_RPM_VMIDMT_SIDR2_ADDR A:0x88028
y.create.l HWIO_RPM_VMIDMT_SIDR4_ADDR A:0x88030
y.create.l HWIO_RPM_VMIDMT_SIDR5_ADDR A:0x88034
y.create.l HWIO_RPM_VMIDMT_SIDR7_ADDR A:0x8803c
y.create.l HWIO_RPM_VMIDMT_SGFAR0_ADDR A:0x88040
y.create.l HWIO_RPM_VMIDMT_SGFSR_ADDR A:0x88048
y.create.l HWIO_RPM_VMIDMT_SGFSRRESTORE_ADDR A:0x8804c
y.create.l HWIO_RPM_VMIDMT_SGFSYNDR0_ADDR A:0x88050
y.create.l HWIO_RPM_VMIDMT_SGFSYNDR1_ADDR A:0x88054
y.create.l HWIO_RPM_VMIDMT_SGFSYNDR2_ADDR A:0x88058
y.create.l HWIO_RPM_VMIDMT_VMIDMTSCR0_ADDR A:0x88090
y.create.l HWIO_RPM_VMIDMT_CR0_ADDR A:0x88000
y.create.l HWIO_RPM_VMIDMT_CR2_ADDR A:0x88008
y.create.l HWIO_RPM_VMIDMT_ACR_ADDR A:0x88010
y.create.l HWIO_RPM_VMIDMT_IDR0_ADDR A:0x88020
y.create.l HWIO_RPM_VMIDMT_IDR1_ADDR A:0x88024
y.create.l HWIO_RPM_VMIDMT_IDR2_ADDR A:0x88028
y.create.l HWIO_RPM_VMIDMT_IDR4_ADDR A:0x88030
y.create.l HWIO_RPM_VMIDMT_IDR5_ADDR A:0x88034
y.create.l HWIO_RPM_VMIDMT_IDR7_ADDR A:0x8803c
y.create.l HWIO_RPM_VMIDMT_GFAR0_ADDR A:0x88040
y.create.l HWIO_RPM_VMIDMT_GFSR_ADDR A:0x88048
y.create.l HWIO_RPM_VMIDMT_GFSRRESTORE_ADDR A:0x8804c
y.create.l HWIO_RPM_VMIDMT_GFSYNDR0_ADDR A:0x88050
y.create.l HWIO_RPM_VMIDMT_GFSYNDR1_ADDR A:0x88054
y.create.l HWIO_RPM_VMIDMT_GFSYNDR2_ADDR A:0x88058
y.create.l HWIO_RPM_VMIDMT_VMIDMTCR0_ADDR A:0x88090
y.create.l HWIO_RPM_VMIDMT_VMIDMTACR_ADDR A:0x8809c
y.create.l HWIO_RPM_VMIDMT_NSCR0_ADDR A:0x88400
y.create.l HWIO_RPM_VMIDMT_NSCR2_ADDR A:0x88408
y.create.l HWIO_RPM_VMIDMT_NSACR_ADDR A:0x88410
y.create.l HWIO_RPM_VMIDMT_NSGFAR0_ADDR A:0x88440
y.create.l HWIO_RPM_VMIDMT_NSGFSR_ADDR A:0x88448
y.create.l HWIO_RPM_VMIDMT_NSGFSRRESTORE_ADDR A:0x8844c
y.create.l HWIO_RPM_VMIDMT_NSGFSYNDR0_ADDR A:0x88450
y.create.l HWIO_RPM_VMIDMT_NSGFSYNDR1_ADDR A:0x88454
y.create.l HWIO_RPM_VMIDMT_NSGFSYNDR2_ADDR A:0x88458
y.create.l HWIO_RPM_VMIDMT_NSVMIDMTCR0_ADDR A:0x88490
y.create.l HWIO_RPM_VMIDMT_SSDR0_ADDR A:0x88080
y.create.l HWIO_RPM_VMIDMT_MSDR0_ADDR A:0x88480
y.create.l HWIO_RPM_VMIDMT_MCR_ADDR A:0x88494
y.create.l HWIO_RPM_VMIDMT_S2VR0_ADDR A:0x88c00
y.create.l HWIO_RPM_VMIDMT_AS2VR0_ADDR A:0x88e00
y.create.l HWIO_RPM_M3_ITM_ITM_STIM0_ADDR A:0xe0000000
y.create.l HWIO_RPM_M3_ITM_ITM_STIM1_ADDR A:0xe0000004
y.create.l HWIO_RPM_M3_ITM_ITM_STIM2_ADDR A:0xe0000008
y.create.l HWIO_RPM_M3_ITM_ITM_STIM3_ADDR A:0xe000000c
y.create.l HWIO_RPM_M3_ITM_ITM_STIM4_ADDR A:0xe0000010
y.create.l HWIO_RPM_M3_ITM_ITM_STIM5_ADDR A:0xe0000014
y.create.l HWIO_RPM_M3_ITM_ITM_STIM6_ADDR A:0xe0000018
y.create.l HWIO_RPM_M3_ITM_ITM_STIM7_ADDR A:0xe000001c
y.create.l HWIO_RPM_M3_ITM_ITM_STIM8_ADDR A:0xe0000020
y.create.l HWIO_RPM_M3_ITM_ITM_STIM9_ADDR A:0xe0000024
y.create.l HWIO_RPM_M3_ITM_ITM_STIM10_ADDR A:0xe0000028
y.create.l HWIO_RPM_M3_ITM_ITM_STIM11_ADDR A:0xe000002c
y.create.l HWIO_RPM_M3_ITM_ITM_STIM12_ADDR A:0xe0000030
y.create.l HWIO_RPM_M3_ITM_ITM_STIM13_ADDR A:0xe0000034
y.create.l HWIO_RPM_M3_ITM_ITM_STIM14_ADDR A:0xe0000038
y.create.l HWIO_RPM_M3_ITM_ITM_STIM15_ADDR A:0xe000003c
y.create.l HWIO_RPM_M3_ITM_ITM_STIM16_ADDR A:0xe0000040
y.create.l HWIO_RPM_M3_ITM_ITM_STIM17_ADDR A:0xe0000044
y.create.l HWIO_RPM_M3_ITM_ITM_STIM18_ADDR A:0xe0000048
y.create.l HWIO_RPM_M3_ITM_ITM_STIM19_ADDR A:0xe000004c
y.create.l HWIO_RPM_M3_ITM_ITM_STIM20_ADDR A:0xe0000050
y.create.l HWIO_RPM_M3_ITM_ITM_STIM21_ADDR A:0xe0000054
y.create.l HWIO_RPM_M3_ITM_ITM_STIM22_ADDR A:0xe0000058
y.create.l HWIO_RPM_M3_ITM_ITM_STIM23_ADDR A:0xe000005c
y.create.l HWIO_RPM_M3_ITM_ITM_STIM24_ADDR A:0xe0000060
y.create.l HWIO_RPM_M3_ITM_ITM_STIM25_ADDR A:0xe0000064
y.create.l HWIO_RPM_M3_ITM_ITM_STIM26_ADDR A:0xe0000068
y.create.l HWIO_RPM_M3_ITM_ITM_STIM27_ADDR A:0xe000006c
y.create.l HWIO_RPM_M3_ITM_ITM_STIM28_ADDR A:0xe0000070
y.create.l HWIO_RPM_M3_ITM_ITM_STIM29_ADDR A:0xe0000074
y.create.l HWIO_RPM_M3_ITM_ITM_STIM30_ADDR A:0xe0000078
y.create.l HWIO_RPM_M3_ITM_ITM_STIM31_ADDR A:0xe000007c
y.create.l HWIO_RPM_M3_ITM_ITM_TER_ADDR A:0xe0000e00
y.create.l HWIO_RPM_M3_ITM_ITM_TPR_ADDR A:0xe0000e40
y.create.l HWIO_RPM_M3_ITM_ITM_TCR_ADDR A:0xe0000e80
y.create.l HWIO_RPM_M3_ITM_ITM_IWR_ADDR A:0xe0000ef8
y.create.l HWIO_RPM_M3_ITM_ITM_IMCR_ADDR A:0xe0000f00
y.create.l HWIO_RPM_M3_ITM_ITM_LAR_ADDR A:0xe0000fb0
y.create.l HWIO_RPM_M3_ITM_ITM_LSR_ADDR A:0xe0000fb4
y.create.l HWIO_RPM_M3_ITM_PID4_ADDR A:0xe0000fd0
y.create.l HWIO_RPM_M3_ITM_PID5_ADDR A:0xe0000fd4
y.create.l HWIO_RPM_M3_ITM_PID6_ADDR A:0xe0000fd8
y.create.l HWIO_RPM_M3_ITM_PID7_ADDR A:0xe0000fdc
y.create.l HWIO_RPM_M3_ITM_PID0_ADDR A:0xe0000fe0
y.create.l HWIO_RPM_M3_ITM_PID1_ADDR A:0xe0000fe4
y.create.l HWIO_RPM_M3_ITM_PID2_ADDR A:0xe0000fe8
y.create.l HWIO_RPM_M3_ITM_PID3_ADDR A:0xe0000fec
y.create.l HWIO_RPM_M3_ITM_CID0_ADDR A:0xe0000ff0
y.create.l HWIO_RPM_M3_ITM_CID1_ADDR A:0xe0000ff4
y.create.l HWIO_RPM_M3_ITM_CID2_ADDR A:0xe0000ff8
y.create.l HWIO_RPM_M3_ITM_CID3_ADDR A:0xe0000ffc
y.create.l HWIO_RPM_M3_DWT_DWT_CTRL_ADDR A:0xe0001000
y.create.l HWIO_RPM_M3_DWT_DWT_CYCCNT_ADDR A:0xe0001004
y.create.l HWIO_RPM_M3_DWT_DWT_CPICNT_ADDR A:0xe0001008
y.create.l HWIO_RPM_M3_DWT_DWT_EXCCNT_ADDR A:0xe000100c
y.create.l HWIO_RPM_M3_DWT_DWT_SLEEPCNT_ADDR A:0xe0001010
y.create.l HWIO_RPM_M3_DWT_DWT_LSUCNT_ADDR A:0xe0001014
y.create.l HWIO_RPM_M3_DWT_DWT_FOLDCNT_ADDR A:0xe0001018
y.create.l HWIO_RPM_M3_DWT_DWT_PCSR_ADDR A:0xe000101c
y.create.l HWIO_RPM_M3_DWT_DWT_COMP0_ADDR A:0xe0001020
y.create.l HWIO_RPM_M3_DWT_DWT_MASK0_ADDR A:0xe0001024
y.create.l HWIO_RPM_M3_DWT_DWT_FUNCTION0_ADDR A:0xe0001028
y.create.l HWIO_RPM_M3_DWT_DWT_COMP1_ADDR A:0xe0001030
y.create.l HWIO_RPM_M3_DWT_DWT_MASK1_ADDR A:0xe0001034
y.create.l HWIO_RPM_M3_DWT_DWT_FUNCTION1_ADDR A:0xe0001038
y.create.l HWIO_RPM_M3_DWT_DWT_COMP2_ADDR A:0xe0001040
y.create.l HWIO_RPM_M3_DWT_DWT_MASK2_ADDR A:0xe0001044
y.create.l HWIO_RPM_M3_DWT_DWT_FUNCTION2_ADDR A:0xe0001048
y.create.l HWIO_RPM_M3_DWT_DWT_COMP3_ADDR A:0xe0001050
y.create.l HWIO_RPM_M3_DWT_DWT_MASK3_ADDR A:0xe0001054
y.create.l HWIO_RPM_M3_DWT_DWT_FUNCTION3_ADDR A:0xe0001058
y.create.l HWIO_RPM_M3_DWT_PID4_ADDR A:0xe0001fd0
y.create.l HWIO_RPM_M3_DWT_PID5_ADDR A:0xe0001fd4
y.create.l HWIO_RPM_M3_DWT_PID6_ADDR A:0xe0001fd8
y.create.l HWIO_RPM_M3_DWT_PID7_ADDR A:0xe0001fdc
y.create.l HWIO_RPM_M3_DWT_PID0_ADDR A:0xe0001fe0
y.create.l HWIO_RPM_M3_DWT_PID1_ADDR A:0xe0001fe4
y.create.l HWIO_RPM_M3_DWT_PID2_ADDR A:0xe0001fe8
y.create.l HWIO_RPM_M3_DWT_PID3_ADDR A:0xe0001fec
y.create.l HWIO_RPM_M3_DWT_CID0_ADDR A:0xe0001ff0
y.create.l HWIO_RPM_M3_DWT_CID1_ADDR A:0xe0001ff4
y.create.l HWIO_RPM_M3_DWT_CID2_ADDR A:0xe0001ff8
y.create.l HWIO_RPM_M3_DWT_CID3_ADDR A:0xe0001ffc
y.create.l HWIO_RPM_M3_FPB_FP_CTRL_ADDR A:0xe0002000
y.create.l HWIO_RPM_M3_FPB_FP_REMAP_ADDR A:0xe0002004
y.create.l HWIO_RPM_M3_FPB_FP_COMP0_ADDR A:0xe0002008
y.create.l HWIO_RPM_M3_FPB_FP_COMP1_ADDR A:0xe000200c
y.create.l HWIO_RPM_M3_FPB_FP_COMP2_ADDR A:0xe0002010
y.create.l HWIO_RPM_M3_FPB_FP_COMP3_ADDR A:0xe0002014
y.create.l HWIO_RPM_M3_FPB_FP_COMP4_ADDR A:0xe0002018
y.create.l HWIO_RPM_M3_FPB_FP_COMP5_ADDR A:0xe000201c
y.create.l HWIO_RPM_M3_FPB_FP_COMP6_ADDR A:0xe0002020
y.create.l HWIO_RPM_M3_FPB_FP_COMP7_ADDR A:0xe0002024
y.create.l HWIO_RPM_M3_FPB_PID4_ADDR A:0xe0002fd0
y.create.l HWIO_RPM_M3_FPB_PID5_ADDR A:0xe0002fd4
y.create.l HWIO_RPM_M3_FPB_PID6_ADDR A:0xe0002fd8
y.create.l HWIO_RPM_M3_FPB_PID7_ADDR A:0xe0002fdc
y.create.l HWIO_RPM_M3_FPB_PID0_ADDR A:0xe0002fe0
y.create.l HWIO_RPM_M3_FPB_PID1_ADDR A:0xe0002fe4
y.create.l HWIO_RPM_M3_FPB_PID2_ADDR A:0xe0002fe8
y.create.l HWIO_RPM_M3_FPB_PID3_ADDR A:0xe0002fec
y.create.l HWIO_RPM_M3_FPB_CID0_ADDR A:0xe0002ff0
y.create.l HWIO_RPM_M3_FPB_CID1_ADDR A:0xe0002ff4
y.create.l HWIO_RPM_M3_FPB_CID2_ADDR A:0xe0002ff8
y.create.l HWIO_RPM_M3_FPB_CID3_ADDR A:0xe0002ffc
y.create.l HWIO_RPM_M3_SCS_ICTR_ADDR A:0xe000e004
y.create.l HWIO_RPM_M3_SCS_ACTLR_ADDR A:0xe000e008
y.create.l HWIO_RPM_M3_SCS_STCSR_ADDR A:0xe000e010
y.create.l HWIO_RPM_M3_SCS_STRVR_ADDR A:0xe000e014
y.create.l HWIO_RPM_M3_SCS_STCVR_ADDR A:0xe000e018
y.create.l HWIO_RPM_M3_SCS_STCR_ADDR A:0xe000e01c
y.create.l HWIO_RPM_M3_SCS_NVIC_ISER0_ADDR A:0xe000e100
y.create.l HWIO_RPM_M3_SCS_NVIC_ISER1_ADDR A:0xe000e104
y.create.l HWIO_RPM_M3_SCS_NVIC_ICER0_ADDR A:0xe000e180
y.create.l HWIO_RPM_M3_SCS_NVIC_ICER1_ADDR A:0xe000e184
y.create.l HWIO_RPM_M3_SCS_NVIC_ISPR0_ADDR A:0xe000e200
y.create.l HWIO_RPM_M3_SCS_NVIC_ISPR1_ADDR A:0xe000e204
y.create.l HWIO_RPM_M3_SCS_NVIC_ICPR0_ADDR A:0xe000e280
y.create.l HWIO_RPM_M3_SCS_NVIC_ICPR1_ADDR A:0xe000e284
y.create.l HWIO_RPM_M3_SCS_NVIC_IABR0_ADDR A:0xe000e300
y.create.l HWIO_RPM_M3_SCS_NVIC_IABR1_ADDR A:0xe000e304
y.create.l HWIO_RPM_M3_SCS_NVIC_IPR0_ADDR A:0xe000e400
y.create.l HWIO_RPM_M3_SCS_NVIC_IPR1_ADDR A:0xe000e404
y.create.l HWIO_RPM_M3_SCS_NVIC_IPR2_ADDR A:0xe000e408
y.create.l HWIO_RPM_M3_SCS_NVIC_IPR3_ADDR A:0xe000e40c
y.create.l HWIO_RPM_M3_SCS_NVIC_IPR4_ADDR A:0xe000e410
y.create.l HWIO_RPM_M3_SCS_NVIC_IPR5_ADDR A:0xe000e414
y.create.l HWIO_RPM_M3_SCS_NVIC_IPR6_ADDR A:0xe000e418
y.create.l HWIO_RPM_M3_SCS_NVIC_IPR7_ADDR A:0xe000e41c
y.create.l HWIO_RPM_M3_SCS_NVIC_IPR8_ADDR A:0xe000e420
y.create.l HWIO_RPM_M3_SCS_NVIC_IPR9_ADDR A:0xe000e424
y.create.l HWIO_RPM_M3_SCS_NVIC_IPR10_ADDR A:0xe000e428
y.create.l HWIO_RPM_M3_SCS_NVIC_IPR11_ADDR A:0xe000e42c
y.create.l HWIO_RPM_M3_SCS_NVIC_IPR12_ADDR A:0xe000e430
y.create.l HWIO_RPM_M3_SCS_NVIC_IPR13_ADDR A:0xe000e434
y.create.l HWIO_RPM_M3_SCS_NVIC_IPR14_ADDR A:0xe000e438
y.create.l HWIO_RPM_M3_SCS_NVIC_IPR15_ADDR A:0xe000e43c
y.create.l HWIO_RPM_M3_SCS_CPUID_ADDR A:0xe000ed00
y.create.l HWIO_RPM_M3_SCS_ICSR_ADDR A:0xe000ed04
y.create.l HWIO_RPM_M3_SCS_VTOR_ADDR A:0xe000ed08
y.create.l HWIO_RPM_M3_SCS_AIRCR_ADDR A:0xe000ed0c
y.create.l HWIO_RPM_M3_SCS_SCR_ADDR A:0xe000ed10
y.create.l HWIO_RPM_M3_SCS_CCR_ADDR A:0xe000ed14
y.create.l HWIO_RPM_M3_SCS_SHPR1_ADDR A:0xe000ed18
y.create.l HWIO_RPM_M3_SCS_SHPR2_ADDR A:0xe000ed1c
y.create.l HWIO_RPM_M3_SCS_SHPR3_ADDR A:0xe000ed20
y.create.l HWIO_RPM_M3_SCS_SHCSR_ADDR A:0xe000ed24
y.create.l HWIO_RPM_M3_SCS_CFSR_ADDR A:0xe000ed28
y.create.l HWIO_RPM_M3_SCS_HFSR_ADDR A:0xe000ed2c
y.create.l HWIO_RPM_M3_SCS_DFSR_ADDR A:0xe000ed30
y.create.l HWIO_RPM_M3_SCS_MMFAR_ADDR A:0xe000ed34
y.create.l HWIO_RPM_M3_SCS_BFAR_ADDR A:0xe000ed38
y.create.l HWIO_RPM_M3_SCS_AFSR_ADDR A:0xe000ed3c
y.create.l HWIO_RPM_M3_SCS_ID_PFR0_ADDR A:0xe000ed40
y.create.l HWIO_RPM_M3_SCS_ID_PFR1_ADDR A:0xe000ed44
y.create.l HWIO_RPM_M3_SCS_ID_DFR0_ADDR A:0xe000ed48
y.create.l HWIO_RPM_M3_SCS_ID_AFR0_ADDR A:0xe000ed4c
y.create.l HWIO_RPM_M3_SCS_ID_MMFR0_ADDR A:0xe000ed50
y.create.l HWIO_RPM_M3_SCS_ID_MMFR1_ADDR A:0xe000ed54
y.create.l HWIO_RPM_M3_SCS_ID_MMFR2_ADDR A:0xe000ed58
y.create.l HWIO_RPM_M3_SCS_ID_MMFR3_ADDR A:0xe000ed5c
y.create.l HWIO_RPM_M3_SCS_ID_ISAR0_ADDR A:0xe000ed60
y.create.l HWIO_RPM_M3_SCS_ID_ISAR1_ADDR A:0xe000ed64
y.create.l HWIO_RPM_M3_SCS_ID_ISAR2_ADDR A:0xe000ed68
y.create.l HWIO_RPM_M3_SCS_ID_ISAR3_ADDR A:0xe000ed6c
y.create.l HWIO_RPM_M3_SCS_ID_ISAR4_ADDR A:0xe000ed70
y.create.l HWIO_RPM_M3_SCS_CPACR_ADDR A:0xe000ed88
y.create.l HWIO_RPM_M3_SCS_MPU_TYPE_ADDR A:0xe000ed90
y.create.l HWIO_RPM_M3_SCS_MPU_CTRL_ADDR A:0xe000ed94
y.create.l HWIO_RPM_M3_SCS_MPU_RNR_ADDR A:0xe000ed98
y.create.l HWIO_RPM_M3_SCS_MPU_RBAR_ADDR A:0xe000ed9c
y.create.l HWIO_RPM_M3_SCS_MPU_RASR_ADDR A:0xe000eda0
y.create.l HWIO_RPM_M3_SCS_MPU_RBAR_A1_ADDR A:0xe000eda4
y.create.l HWIO_RPM_M3_SCS_MPU_RASR_A1_ADDR A:0xe000eda8
y.create.l HWIO_RPM_M3_SCS_MPU_RBAR_A2_ADDR A:0xe000edac
y.create.l HWIO_RPM_M3_SCS_MPU_RASR_A2_ADDR A:0xe000edb0
y.create.l HWIO_RPM_M3_SCS_MPU_RBAR_A3_ADDR A:0xe000edb4
y.create.l HWIO_RPM_M3_SCS_MPU_RASR_A3_ADDR A:0xe000edb8
y.create.l HWIO_RPM_M3_SCS_DHCSR_ADDR A:0xe000edf0
y.create.l HWIO_RPM_M3_SCS_DCRSR_ADDR A:0xe000edf4
y.create.l HWIO_RPM_M3_SCS_DCRDR_ADDR A:0xe000edf8
y.create.l HWIO_RPM_M3_SCS_DEMCR_ADDR A:0xe000edfc
y.create.l HWIO_RPM_M3_SCS_STIR_ADDR A:0xe000ef00
y.create.l HWIO_RPM_M3_SCS_PID4_ADDR A:0xe000efd0
y.create.l HWIO_RPM_M3_SCS_PID5_ADDR A:0xe000efd4
y.create.l HWIO_RPM_M3_SCS_PID6_ADDR A:0xe000efd8
y.create.l HWIO_RPM_M3_SCS_PID7_ADDR A:0xe000efdc
y.create.l HWIO_RPM_M3_SCS_PID0_ADDR A:0xe000efe0
y.create.l HWIO_RPM_M3_SCS_PID1_ADDR A:0xe000efe4
y.create.l HWIO_RPM_M3_SCS_PID2_ADDR A:0xe000efe8
y.create.l HWIO_RPM_M3_SCS_PID3_ADDR A:0xe000efec
y.create.l HWIO_RPM_M3_SCS_CID0_ADDR A:0xe000eff0
y.create.l HWIO_RPM_M3_SCS_CID1_ADDR A:0xe000eff4
y.create.l HWIO_RPM_M3_SCS_CID2_ADDR A:0xe000eff8
y.create.l HWIO_RPM_M3_SCS_CID3_ADDR A:0xe000effc
y.create.l HWIO_RPM_M3_ETM_ETMCR_ADDR A:0xe0041000
y.create.l HWIO_RPM_M3_ETM_ETMCCR_ADDR A:0xe0041004
y.create.l HWIO_RPM_M3_ETM_ETMTRIGGER_ADDR A:0xe0041008
y.create.l HWIO_RPM_M3_ETM_ETMSR_ADDR A:0xe0041010
y.create.l HWIO_RPM_M3_ETM_ETMSCR_ADDR A:0xe0041014
y.create.l HWIO_RPM_M3_ETM_ETMTEEVR_ADDR A:0xe0041020
y.create.l HWIO_RPM_M3_ETM_ETMTECR1_ADDR A:0xe0041024
y.create.l HWIO_RPM_M3_ETM_ETMFFLR_ADDR A:0xe0041028
y.create.l HWIO_RPM_M3_ETM_ETMCNTRLDVR1_ADDR A:0xe0041140
y.create.l HWIO_RPM_M3_ETM_ETMSYNCFR_ADDR A:0xe00411e0
y.create.l HWIO_RPM_M3_ETM_ETMIDR_ADDR A:0xe00411e4
y.create.l HWIO_RPM_M3_ETM_ETMCCER_ADDR A:0xe00411e8
y.create.l HWIO_RPM_M3_ETM_ETMTESSEICR_ADDR A:0xe00411f0
y.create.l HWIO_RPM_M3_ETM_ETMTSEVR_ADDR A:0xe00411f8
y.create.l HWIO_RPM_M3_ETM_ETMTRACEIDR_ADDR A:0xe0041200
y.create.l HWIO_RPM_M3_ETM_ETMIDR2_ADDR A:0xe0041208
y.create.l HWIO_RPM_M3_ETM_ETMPDSR_ADDR A:0xe0041314
y.create.l HWIO_RPM_M3_ETM_ITMISCIN_ADDR A:0xe0041ee0
y.create.l HWIO_RPM_M3_ETM_ITTRIGOUT_ADDR A:0xe0041ee8
y.create.l HWIO_RPM_M3_ETM_ETM_ITATBCTR2_ADDR A:0xe0041ef0
y.create.l HWIO_RPM_M3_ETM_ETM_ITATBCTR0_ADDR A:0xe0041ef8
y.create.l HWIO_RPM_M3_ETM_ETMITCTRL_ADDR A:0xe0041f00
y.create.l HWIO_RPM_M3_ETM_ETMCLAIMSET_ADDR A:0xe0041fa0
y.create.l HWIO_RPM_M3_ETM_ETMCLAIMCLR_ADDR A:0xe0041fa4
y.create.l HWIO_RPM_M3_ETM_ETMLAR_ADDR A:0xe0041fb0
y.create.l HWIO_RPM_M3_ETM_ETMLSR_ADDR A:0xe0041fb4
y.create.l HWIO_RPM_M3_ETM_ETMAUTHSTATUS_ADDR A:0xe0041fb8
y.create.l HWIO_RPM_M3_ETM_ETMDEVTYPE_ADDR A:0xe0041fcc
y.create.l HWIO_RPM_M3_ETM_ETMPID4_ADDR A:0xe0041fd0
y.create.l HWIO_RPM_M3_ETM_ETMPID5_ADDR A:0xe0041fd4
y.create.l HWIO_RPM_M3_ETM_ETMPID6_ADDR A:0xe0041fd8
y.create.l HWIO_RPM_M3_ETM_ETMPID7_ADDR A:0xe0041fdc
y.create.l HWIO_RPM_M3_ETM_ETMPID0_ADDR A:0xe0041fe0
y.create.l HWIO_RPM_M3_ETM_ETMPID1_ADDR A:0xe0041fe4
y.create.l HWIO_RPM_M3_ETM_ETMPID2_ADDR A:0xe0041fe8
y.create.l HWIO_RPM_M3_ETM_ETMPID3_ADDR A:0xe0041fec
y.create.l HWIO_RPM_M3_ETM_ETMCID0_ADDR A:0xe0041ff0
y.create.l HWIO_RPM_M3_ETM_ETMCID1_ADDR A:0xe0041ff4
y.create.l HWIO_RPM_M3_ETM_ETMCID2_ADDR A:0xe0041ff8
y.create.l HWIO_RPM_M3_ETM_ETMCID3_ADDR A:0xe0041ffc
y.create.l HWIO_RPM_M3_ROM_TABLE_SCS_ADDR A:0xe00ff000
y.create.l HWIO_RPM_M3_ROM_TABLE_DWT_ADDR A:0xe00ff004
y.create.l HWIO_RPM_M3_ROM_TABLE_FPB_ADDR A:0xe00ff008
y.create.l HWIO_RPM_M3_ROM_TABLE_ITM_ADDR A:0xe00ff00c
y.create.l HWIO_RPM_M3_ROM_TABLE_TPIU_ADDR A:0xe00ff010
y.create.l HWIO_RPM_M3_ROM_TABLE_ETM_ADDR A:0xe00ff014
y.create.l HWIO_RPM_M3_ROM_TABLE_END_ADDR A:0xe00ff018
y.create.l HWIO_RPM_M3_ROM_TABLE_SYSTEM_ACCESS_ADDR A:0xe00fffcc
y.create.l HWIO_RPM_M3_ROM_TABLE_PID4_ADDR A:0xe00fffd0
y.create.l HWIO_RPM_M3_ROM_TABLE_PID5_ADDR A:0xe00fffd4
y.create.l HWIO_RPM_M3_ROM_TABLE_PID6_ADDR A:0xe00fffd8
y.create.l HWIO_RPM_M3_ROM_TABLE_PID7_ADDR A:0xe00fffdc
y.create.l HWIO_RPM_M3_ROM_TABLE_PID0_ADDR A:0xe00fffe0
y.create.l HWIO_RPM_M3_ROM_TABLE_PID1_ADDR A:0xe00fffe4
y.create.l HWIO_RPM_M3_ROM_TABLE_PID2_ADDR A:0xe00fffe8
y.create.l HWIO_RPM_M3_ROM_TABLE_PID3_ADDR A:0xe00fffec
y.create.l HWIO_RPM_M3_ROM_TABLE_CID0_ADDR A:0xe00ffff0
y.create.l HWIO_RPM_M3_ROM_TABLE_CID1_ADDR A:0xe00ffff4
y.create.l HWIO_RPM_M3_ROM_TABLE_CID2_ADDR A:0xe00ffff8
y.create.l HWIO_RPM_M3_ROM_TABLE_CID3_ADDR A:0xe00ffffc
y.create.l HWIO_SDC1_SDCC_MCI_POWER_ADDR A:0x67824000
y.create.l HWIO_SDC1_SDCC_MCI_CLK_ADDR A:0x67824004
y.create.l HWIO_SDC1_SDCC_MCI_ARGUMENT_ADDR A:0x67824008
y.create.l HWIO_SDC1_SDCC_MCI_CMD_ADDR A:0x6782400c
y.create.l HWIO_SDC1_SDCC_MCI_RESP_CMD_ADDR A:0x67824010
y.create.l HWIO_SDC1_SDCC_MCI_RESP0_ADDR A:0x67824014
y.create.l HWIO_SDC1_SDCC_MCI_RESP1_ADDR A:0x67824018
y.create.l HWIO_SDC1_SDCC_MCI_RESP2_ADDR A:0x6782401c
y.create.l HWIO_SDC1_SDCC_MCI_RESP3_ADDR A:0x67824020
y.create.l HWIO_SDC1_SDCC_MCI_DATA_TIMER_ADDR A:0x67824024
y.create.l HWIO_SDC1_SDCC_MCI_DATA_LENGTH_ADDR A:0x67824028
y.create.l HWIO_SDC1_SDCC_MCI_DATA_CTL_ADDR A:0x6782402c
y.create.l HWIO_SDC1_SDCC_MCI_DATA_COUNT_ADDR A:0x67824030
y.create.l HWIO_SDC1_SDCC_MCI_STATUS_ADDR A:0x67824034
y.create.l HWIO_SDC1_SDCC_MCI_CLEAR_ADDR A:0x67824038
y.create.l HWIO_SDC1_SDCC_MCI_INT_MASK0_ADDR A:0x6782403c
y.create.l HWIO_SDC1_SDCC_MCI_INT_MASK1_ADDR A:0x67824040
y.create.l HWIO_SDC1_SDCC_MCI_FIFO_COUNT_ADDR A:0x67824044
y.create.l HWIO_SDC1_SDCC_MCI_BOOT_ADDR A:0x67824048
y.create.l HWIO_SDC1_SDCC_MCI_BOOT_ACK_TIMER_ADDR A:0x6782404c
y.create.l HWIO_SDC1_SDCC_MCI_VERSION_ADDR A:0x67824050
y.create.l HWIO_SDC1_SDCC_MCI_EMULATION_DLY_LINE_ADDR A:0x67824054
y.create.l HWIO_SDC1_SDCC_MCI_CCS_TIMER_ADDR A:0x67824058
y.create.l HWIO_SDC1_SDCC_MCI_RESPONSE_MASK_ADDR A:0x6782405c
y.create.l HWIO_SDC1_SDCC_MCI_DLL_CONFIG_ADDR A:0x67824060
y.create.l HWIO_SDC1_SDCC_MCI_DLL_TEST_CTL_ADDR A:0x67824064
y.create.l HWIO_SDC1_SDCC_MCI_DLL_STATUS_ADDR A:0x67824068
y.create.l HWIO_SDC1_SDCC_MCI_STATUS2_ADDR A:0x6782406c
y.create.l HWIO_SDC1_SDCC_MCI_GENERICS_ADDR A:0x67824070
y.create.l HWIO_SDC1_SDCC_MCI_FIFO_STATUS_ADDR A:0x67824074
y.create.l HWIO_SDC1_SDCC_MCI_HC_MODE_ADDR A:0x67824078
y.create.l HWIO_SDC1_SDCC_MCI_FIFO0_ADDR A:0x67824080
y.create.l HWIO_SDC1_SDCC_MCI_FIFO1_ADDR A:0x67824084
y.create.l HWIO_SDC1_SDCC_MCI_FIFO2_ADDR A:0x67824088
y.create.l HWIO_SDC1_SDCC_MCI_FIFO3_ADDR A:0x6782408c
y.create.l HWIO_SDC1_SDCC_MCI_FIFO4_ADDR A:0x67824090
y.create.l HWIO_SDC1_SDCC_MCI_FIFO5_ADDR A:0x67824094
y.create.l HWIO_SDC1_SDCC_MCI_FIFO6_ADDR A:0x67824098
y.create.l HWIO_SDC1_SDCC_MCI_FIFO7_ADDR A:0x6782409c
y.create.l HWIO_SDC1_SDCC_MCI_FIFO8_ADDR A:0x678240a0
y.create.l HWIO_SDC1_SDCC_MCI_FIFO9_ADDR A:0x678240a4
y.create.l HWIO_SDC1_SDCC_MCI_TESTBUS_CONFIG_ADDR A:0x678240cc
y.create.l HWIO_SDC1_SDCC_MCI_TEST_CTL_ADDR A:0x678240d0
y.create.l HWIO_SDC1_SDCC_MCI_TEST_INPUT_ADDR A:0x678240d4
y.create.l HWIO_SDC1_SDCC_MCI_TEST_OUT_ADDR A:0x678240d8
y.create.l HWIO_SDC1_SDCC_MCI_PWRCTL_STATUS_REG_ADDR A:0x678240dc
y.create.l HWIO_SDC1_SDCC_MCI_PWRCTL_MASK_REG_ADDR A:0x678240e0
y.create.l HWIO_SDC1_SDCC_MCI_PWRCTL_CLEAR_REG_ADDR A:0x678240e4
y.create.l HWIO_SDC1_SDCC_MCI_PWRCTL_CTL_REG_ADDR A:0x678240e8
y.create.l HWIO_SDC1_SDCC_MCI_CLEAR2_ADDR A:0x678240ec
y.create.l HWIO_SDC1_SDCC_MCI_INT_MASKINT2_0_ADDR A:0x678240f0
y.create.l HWIO_SDC1_SDCC_MCI_INT_MASKINT2_1_ADDR A:0x678240f4
y.create.l HWIO_SDC1_SDCC_CHAR_CFG_ADDR A:0x678240fc
y.create.l HWIO_SDC1_SDCC_CHAR_CMD_ADDR A:0x67824100
y.create.l HWIO_SDC1_SDCC_CHAR_DATA_0_ADDR A:0x67824104
y.create.l HWIO_SDC1_SDCC_CHAR_DATA_1_ADDR A:0x67824108
y.create.l HWIO_SDC1_SDCC_CHAR_DATA_2_ADDR A:0x6782410c
y.create.l HWIO_SDC1_SDCC_CHAR_DATA_3_ADDR A:0x67824110
y.create.l HWIO_SDC1_SDCC_CHAR_DATA_4_ADDR A:0x67824114
y.create.l HWIO_SDC1_SDCC_CHAR_DATA_5_ADDR A:0x67824118
y.create.l HWIO_SDC1_SDCC_CHAR_DATA_6_ADDR A:0x6782411c
y.create.l HWIO_SDC1_SDCC_CHAR_DATA_7_ADDR A:0x67824120
y.create.l HWIO_SDC1_SDCC_DEBUG_REG_ADDR A:0x67824124
y.create.l HWIO_SDC1_SDCC_IP_CATALOG_ADDR A:0x67824128
y.create.l HWIO_SDC1_SDCC_QSB_VALUES_ADDR A:0x6782412c
y.create.l HWIO_SDC1_SDCC_QSB_AXI_VALUES_ADDR A:0x67824130
y.create.l HWIO_SDC1_SDCC_AXI_DATA_ERR_DBUG_ADDR A:0x67824134
y.create.l HWIO_SDC1_SDCC_T4_DLY_CTRL_ADDR A:0x67824138
y.create.l HWIO_SDC1_SDCC_T4_DLY_STAT_ADDR A:0x6782413c
y.create.l HWIO_SDC1_SDCC_CSR_CDC_CTLR_CFG0_ADDR A:0x67824140
y.create.l HWIO_SDC1_SDCC_CSR_CDC_CTLR_CFG1_ADDR A:0x67824144
y.create.l HWIO_SDC1_SDCC_CSR_CDC_CAL_TIMER_CFG0_ADDR A:0x67824148
y.create.l HWIO_SDC1_SDCC_CSR_CDC_CAL_TIMER_CFG1_ADDR A:0x6782414c
y.create.l HWIO_SDC1_SDCC_CSR_CDC_REFCOUNT_CFG_ADDR A:0x67824150
y.create.l HWIO_SDC1_SDCC_CSR_CDC_COARSE_CAL_CFG_ADDR A:0x67824154
y.create.l HWIO_SDC1_SDCC_CSR_CDC_RSVD_CFG_ADDR A:0x67824158
y.create.l HWIO_SDC1_SDCC_CSR_CDC_OFFSET_CFG_ADDR A:0x6782415c
y.create.l HWIO_SDC1_SDCC_CSR_CDC_DELAY_CFG_ADDR A:0x67824160
y.create.l HWIO_SDC1_SDCC_CSR_CDC_SW_MODE_CFG_ADDR A:0x67824164
y.create.l HWIO_SDC1_SDCC_CSR_CDC_TEST_CFG_ADDR A:0x67824168
y.create.l HWIO_SDC1_SDCC_CSR_CDC_SW_OVRD_CFG_ADDR A:0x6782416c
y.create.l HWIO_SDC1_SDCC_CSR_CDC_SLAVE_DDA_CFG_ADDR A:0x67824170
y.create.l HWIO_SDC1_SDCC_CSR_CDC_STATUS0_ADDR A:0x67824174
y.create.l HWIO_SDC1_SDCC_CSR_CDC_STATUS1_ADDR A:0x67824178
y.create.l HWIO_SDC1_SDCC_CSR_CDC_STATUS2_ADDR A:0x6782417c
y.create.l HWIO_SDC1_SDCC_CSR_CDC_STATUS3_ADDR A:0x67824180
y.create.l HWIO_SDC1_SDCC_CSR_CDC_STATUS4_ADDR A:0x67824184
y.create.l HWIO_SDC1_SDCC_CSR_CDC_GEN_CFG_ADDR A:0x67824188
y.create.l HWIO_SDC1_SDCC_CDC_AUTO_SW_CAL_CFG_ADDR A:0x6782418c
y.create.l HWIO_SDC1_SDCC_DDR200_STAT_ADDR A:0x67824190
y.create.l HWIO_SDC1_SDCC_DDR200_CFG_ADDR A:0x67824194
y.create.l HWIO_SDC1_SDCC_TIME_COUNT_CTRL_ADDR A:0x67824198
y.create.l HWIO_SDC1_SDCC_FLOW_CTRL_TIME_COUNT_ADDR A:0x6782419c
y.create.l HWIO_SDC1_SDCC_BUSY_TIME_COUNT_ADDR A:0x678241a0
y.create.l HWIO_SDC1_SDCC_DATA_TIME_COUNT_ADDR A:0x678241a4
y.create.l HWIO_SDC1_SDCC_CMD_TIME_COUNT_ADDR A:0x678241a8
y.create.l HWIO_SDC1_SDCC_MCI_DLL_CONFIG_2_ADDR A:0x678241ac
y.create.l HWIO_SDC1_SDCC_MCI_DDR_CONFIG_ADDR A:0x678241b0
y.create.l HWIO_SDC1_SDCC_MCI_FIFO_ALT0_ADDR A:0x67824400
y.create.l HWIO_SDC1_SDCC_MCI_FIFO_ALT1_ADDR A:0x67824404
y.create.l HWIO_SDC1_SDCC_MCI_FIFO_ALT2_ADDR A:0x67824408
y.create.l HWIO_SDC1_SDCC_MCI_FIFO_ALT3_ADDR A:0x6782440c
y.create.l HWIO_SDC1_SDCC_MCI_FIFO_ALT4_ADDR A:0x67824410
y.create.l HWIO_SDC1_SDCC_MCI_FIFO_ALT5_ADDR A:0x67824414
y.create.l HWIO_SDC1_SDCC_MCI_FIFO_ALT6_ADDR A:0x67824418
y.create.l HWIO_SDC1_SDCC_MCI_FIFO_ALT7_ADDR A:0x6782441c
y.create.l HWIO_SDC1_SDCC_MCI_FIFO_ALT8_ADDR A:0x67824420
y.create.l HWIO_SDC1_SDCC_MCI_FIFO_ALT9_ADDR A:0x67824424
y.create.l HWIO_SDC1_SDCC_HC_REG_0_2_ADDR A:0x67824900
y.create.l HWIO_SDC1_SDCC_HC_REG_4_6_ADDR A:0x67824904
y.create.l HWIO_SDC1_SDCC_HC_REG_8_A_ADDR A:0x67824908
y.create.l HWIO_SDC1_SDCC_HC_REG_C_E_ADDR A:0x6782490c
y.create.l HWIO_SDC1_SDCC_HC_REG_10_12_ADDR A:0x67824910
y.create.l HWIO_SDC1_SDCC_HC_REG_14_16_ADDR A:0x67824914
y.create.l HWIO_SDC1_SDCC_HC_REG_18_1A_ADDR A:0x67824918
y.create.l HWIO_SDC1_SDCC_HC_REG_1C_1E_ADDR A:0x6782491c
y.create.l HWIO_SDC1_SDCC_HC_REG_20_22_ADDR A:0x67824920
y.create.l HWIO_SDC1_SDCC_HC_REG_24_26_ADDR A:0x67824924
y.create.l HWIO_SDC1_SDCC_HC_REG_28_2A_ADDR A:0x67824928
y.create.l HWIO_SDC1_SDCC_HC_REG_2C_2E_ADDR A:0x6782492c
y.create.l HWIO_SDC1_SDCC_HC_REG_30_32_ADDR A:0x67824930
y.create.l HWIO_SDC1_SDCC_HC_REG_34_36_ADDR A:0x67824934
y.create.l HWIO_SDC1_SDCC_HC_REG_38_3A_ADDR A:0x67824938
y.create.l HWIO_SDC1_SDCC_HC_REG_3C_3E_ADDR A:0x6782493c
y.create.l HWIO_SDC1_SDCC_HC_REG_40_42_ADDR A:0x67824940
y.create.l HWIO_SDC1_SDCC_HC_REG_44_46_ADDR A:0x67824944
y.create.l HWIO_SDC1_SDCC_HC_REG_48_4A_ADDR A:0x67824948
y.create.l HWIO_SDC1_SDCC_HC_REG_50_52_ADDR A:0x67824950
y.create.l HWIO_SDC1_SDCC_HC_REG_54_56_ADDR A:0x67824954
y.create.l HWIO_SDC1_SDCC_HC_REG_58_5A_ADDR A:0x67824958
y.create.l HWIO_SDC1_SDCC_HC_REG_5C_5E_ADDR A:0x6782495c
y.create.l HWIO_SDC1_SDCC_HC_REG_60_62_ADDR A:0x67824960
y.create.l HWIO_SDC1_SDCC_HC_REG_64_66_ADDR A:0x67824964
y.create.l HWIO_SDC1_SDCC_HC_REG_68_6A_ADDR A:0x67824968
y.create.l HWIO_SDC1_SDCC_HC_REG_6C_6E_ADDR A:0x6782496c
y.create.l HWIO_SDC1_SDCC_HC_REG_E0_E2_ADDR A:0x678249e0
y.create.l HWIO_SDC1_SDCC_HC_REG_FC_FE_ADDR A:0x678249fc
y.create.l HWIO_SDC1_SDCC_HC_REG_DLL_CONFIG_ADDR A:0x67824a00
y.create.l HWIO_SDC1_SDCC_HC_REG_DLL_TEST_CTL_ADDR A:0x67824a04
y.create.l HWIO_SDC1_SDCC_HC_REG_DLL_STATUS_ADDR A:0x67824a08
y.create.l HWIO_SDC1_SDCC_HC_VENDOR_SPECIFIC_FUNC_ADDR A:0x67824a0c
y.create.l HWIO_SDC1_SDCC_HC_VENDOR_SPECIFIC_FUNC2_ADDR A:0x67824a10
y.create.l HWIO_SDC1_SDCC_HC_VENDOR_SPECIFIC_ADMA_ERR_ADDR0_ADDR A:0x67824a14
y.create.l HWIO_SDC1_SDCC_HC_VENDOR_SPECIFIC_ADMA_ERR_ADDR1_ADDR A:0x67824a18
y.create.l HWIO_SDC1_SDCC_HC_VENDOR_SPECIFIC_CAPABILITIES0_ADDR A:0x67824a1c
y.create.l HWIO_SDC1_SDCC_HC_VENDOR_SPECIFIC_CAPABILITIES1_ADDR A:0x67824a20
y.create.l HWIO_SDC1_SDCC_HC_VENDOR_SPECIFIC_T4_DLY_CTRL_ADDR A:0x67824a24
y.create.l HWIO_SDC1_SDCC_HC_VENDOR_SPECIFIC_T4_DLY_STAT_ADDR A:0x67824a28
y.create.l HWIO_SDC1_SDCC_HC_VENDOR_SPECIFIC_CSR_CDC_CTLR_CFG0_ADDR A:0x67824a30
y.create.l HWIO_SDC1_SDCC_HC_VENDOR_SPECIFIC_CSR_CDC_CTLR_CFG1_ADDR A:0x67824a34
y.create.l HWIO_SDC1_SDCC_HC_VENDOR_SPECIFIC_CSR_CDC_CAL_TIMER_CFG0_ADDR A:0x67824a38
y.create.l HWIO_SDC1_SDCC_HC_VENDOR_SPECIFIC_CSR_CDC_CAL_TIMER_CFG1_ADDR A:0x67824a3c
y.create.l HWIO_SDC1_SDCC_HC_VENDOR_SPECIFIC_CSR_CDC_REFCOUNT_CFG_ADDR A:0x67824a40
y.create.l HWIO_SDC1_SDCC_HC_VENDOR_SPECIFIC_CSR_CDC_COARSE_CAL_CFG_ADDR A:0x67824a44
y.create.l HWIO_SDC1_SDCC_HC_VENDOR_SPECIFIC_CSR_CDC_RSVD_CFG_ADDR A:0x67824a48
y.create.l HWIO_SDC1_SDCC_HC_VENDOR_SPECIFIC_CSR_CDC_OFFSET_CFG_ADDR A:0x67824a4c
y.create.l HWIO_SDC1_SDCC_HC_VENDOR_SPECIFIC_CSR_CDC_DELAY_CFG_ADDR A:0x67824a50
y.create.l HWIO_SDC1_SDCC_HC_VENDOR_SPECIFIC_CSR_CDC_SW_MODE_CFG_ADDR A:0x67824a54
y.create.l HWIO_SDC1_SDCC_HC_VENDOR_SPECIFIC_CSR_CDC_TEST_CFG_ADDR A:0x67824a58
y.create.l HWIO_SDC1_SDCC_HC_VENDOR_SPECIFIC_CSR_CDC_SW_OVRD_CFG_ADDR A:0x67824a5c
y.create.l HWIO_SDC1_SDCC_HC_VENDOR_SPECIFIC_CSR_CDC_SLAVE_DDA_CFG_ADDR A:0x67824a60
y.create.l HWIO_SDC1_SDCC_HC_VENDOR_SPECIFIC_CSR_CDC_STATUS0_ADDR A:0x67824a64
y.create.l HWIO_SDC1_SDCC_HC_VENDOR_SPECIFIC_CSR_CDC_STATUS1_ADDR A:0x67824a68
y.create.l HWIO_SDC1_SDCC_HC_VENDOR_SPECIFIC_CSR_CDC_STATUS2_ADDR A:0x67824a6c
y.create.l HWIO_SDC1_SDCC_HC_VENDOR_SPECIFIC_CSR_CDC_STATUS3_ADDR A:0x67824a70
y.create.l HWIO_SDC1_SDCC_HC_VENDOR_SPECIFIC_CSR_CDC_STATUS4_ADDR A:0x67824a74
y.create.l HWIO_SDC1_SDCC_HC_VENDOR_SPECIFIC_CSR_CDC_GEN_CFG_ADDR A:0x67824a78
y.create.l HWIO_SDC1_SDCC_HC_VENDOR_SPECIFIC_CDC_AUTO_SW_CAL_CFG_ADDR A:0x67824a7c
y.create.l HWIO_SDC1_SDCC_HC_VENDOR_SPECIFIC_DDR200_STAT_ADDR A:0x67824a80
y.create.l HWIO_SDC1_SDCC_HC_VENDOR_SPECIFIC_DDR200_CFG_ADDR A:0x67824a84
y.create.l HWIO_SDC1_SDCC_HC_VENDOR_SPECIFIC_TIME_COUNT_CTRL_ADDR A:0x67824a88
y.create.l HWIO_SDC1_SDCC_HC_VENDOR_SPECIFIC_FLOW_CTRL_TIME_COUNT_ADDR A:0x67824a8c
y.create.l HWIO_SDC1_SDCC_HC_VENDOR_SPECIFIC_BUSY_TIME_COUNT_ADDR A:0x67824a90
y.create.l HWIO_SDC1_SDCC_HC_VENDOR_SPECIFIC_DATA_TIME_COUNT_ADDR A:0x67824a94
y.create.l HWIO_SDC1_SDCC_HC_VENDOR_SPECIFIC_CMD_TIME_COUNT_ADDR A:0x67824a98
y.create.l HWIO_SDC1_SDCC_HC_VENDOR_SPECIFIC_ERR_INT_STS_ADDR A:0x67824a9c
y.create.l HWIO_SDC1_SDCC_HC_VENDOR_SPECIFIC_PWRCTL_STATUS_REG_ADDR A:0x67824aa0
y.create.l HWIO_SDC1_SDCC_HC_VENDOR_SPECIFIC_PWRCTL_MASK_REG_ADDR A:0x67824aa4
y.create.l HWIO_SDC1_SDCC_HC_VENDOR_SPECIFIC_PWRCTL_CLEAR_REG_ADDR A:0x67824aa8
y.create.l HWIO_SDC1_SDCC_HC_VENDOR_SPECIFIC_PWRCTL_CTL_REG_ADDR A:0x67824aac
y.create.l HWIO_SDC1_SDCC_HC_VENDOR_SPECIFIC_FUNC3_ADDR A:0x67824ab0
y.create.l HWIO_SDC1_SDCC_HC_REG_DLL_CONFIG_2_ADDR A:0x67824ab4
y.create.l HWIO_SDC1_SDCC_HC_REG_DDR_CONFIG_ADDR A:0x67824ab8
y.create.l HWIO_SDC2_SDCC_MCI_POWER_ADDR A:0x67864000
y.create.l HWIO_SDC2_SDCC_MCI_CLK_ADDR A:0x67864004
y.create.l HWIO_SDC2_SDCC_MCI_ARGUMENT_ADDR A:0x67864008
y.create.l HWIO_SDC2_SDCC_MCI_CMD_ADDR A:0x6786400c
y.create.l HWIO_SDC2_SDCC_MCI_RESP_CMD_ADDR A:0x67864010
y.create.l HWIO_SDC2_SDCC_MCI_RESP0_ADDR A:0x67864014
y.create.l HWIO_SDC2_SDCC_MCI_RESP1_ADDR A:0x67864018
y.create.l HWIO_SDC2_SDCC_MCI_RESP2_ADDR A:0x6786401c
y.create.l HWIO_SDC2_SDCC_MCI_RESP3_ADDR A:0x67864020
y.create.l HWIO_SDC2_SDCC_MCI_DATA_TIMER_ADDR A:0x67864024
y.create.l HWIO_SDC2_SDCC_MCI_DATA_LENGTH_ADDR A:0x67864028
y.create.l HWIO_SDC2_SDCC_MCI_DATA_CTL_ADDR A:0x6786402c
y.create.l HWIO_SDC2_SDCC_MCI_DATA_COUNT_ADDR A:0x67864030
y.create.l HWIO_SDC2_SDCC_MCI_STATUS_ADDR A:0x67864034
y.create.l HWIO_SDC2_SDCC_MCI_CLEAR_ADDR A:0x67864038
y.create.l HWIO_SDC2_SDCC_MCI_INT_MASK0_ADDR A:0x6786403c
y.create.l HWIO_SDC2_SDCC_MCI_INT_MASK1_ADDR A:0x67864040
y.create.l HWIO_SDC2_SDCC_MCI_FIFO_COUNT_ADDR A:0x67864044
y.create.l HWIO_SDC2_SDCC_MCI_BOOT_ADDR A:0x67864048
y.create.l HWIO_SDC2_SDCC_MCI_BOOT_ACK_TIMER_ADDR A:0x6786404c
y.create.l HWIO_SDC2_SDCC_MCI_VERSION_ADDR A:0x67864050
y.create.l HWIO_SDC2_SDCC_MCI_EMULATION_DLY_LINE_ADDR A:0x67864054
y.create.l HWIO_SDC2_SDCC_MCI_CCS_TIMER_ADDR A:0x67864058
y.create.l HWIO_SDC2_SDCC_MCI_RESPONSE_MASK_ADDR A:0x6786405c
y.create.l HWIO_SDC2_SDCC_MCI_DLL_CONFIG_ADDR A:0x67864060
y.create.l HWIO_SDC2_SDCC_MCI_DLL_TEST_CTL_ADDR A:0x67864064
y.create.l HWIO_SDC2_SDCC_MCI_DLL_STATUS_ADDR A:0x67864068
y.create.l HWIO_SDC2_SDCC_MCI_STATUS2_ADDR A:0x6786406c
y.create.l HWIO_SDC2_SDCC_MCI_GENERICS_ADDR A:0x67864070
y.create.l HWIO_SDC2_SDCC_MCI_FIFO_STATUS_ADDR A:0x67864074
y.create.l HWIO_SDC2_SDCC_MCI_HC_MODE_ADDR A:0x67864078
y.create.l HWIO_SDC2_SDCC_MCI_FIFO0_ADDR A:0x67864080
y.create.l HWIO_SDC2_SDCC_MCI_FIFO1_ADDR A:0x67864084
y.create.l HWIO_SDC2_SDCC_MCI_FIFO2_ADDR A:0x67864088
y.create.l HWIO_SDC2_SDCC_MCI_FIFO3_ADDR A:0x6786408c
y.create.l HWIO_SDC2_SDCC_MCI_FIFO4_ADDR A:0x67864090
y.create.l HWIO_SDC2_SDCC_MCI_FIFO5_ADDR A:0x67864094
y.create.l HWIO_SDC2_SDCC_MCI_FIFO6_ADDR A:0x67864098
y.create.l HWIO_SDC2_SDCC_MCI_FIFO7_ADDR A:0x6786409c
y.create.l HWIO_SDC2_SDCC_MCI_FIFO8_ADDR A:0x678640a0
y.create.l HWIO_SDC2_SDCC_MCI_FIFO9_ADDR A:0x678640a4
y.create.l HWIO_SDC2_SDCC_MCI_TESTBUS_CONFIG_ADDR A:0x678640cc
y.create.l HWIO_SDC2_SDCC_MCI_TEST_CTL_ADDR A:0x678640d0
y.create.l HWIO_SDC2_SDCC_MCI_TEST_INPUT_ADDR A:0x678640d4
y.create.l HWIO_SDC2_SDCC_MCI_TEST_OUT_ADDR A:0x678640d8
y.create.l HWIO_SDC2_SDCC_MCI_PWRCTL_STATUS_REG_ADDR A:0x678640dc
y.create.l HWIO_SDC2_SDCC_MCI_PWRCTL_MASK_REG_ADDR A:0x678640e0
y.create.l HWIO_SDC2_SDCC_MCI_PWRCTL_CLEAR_REG_ADDR A:0x678640e4
y.create.l HWIO_SDC2_SDCC_MCI_PWRCTL_CTL_REG_ADDR A:0x678640e8
y.create.l HWIO_SDC2_SDCC_MCI_CLEAR2_ADDR A:0x678640ec
y.create.l HWIO_SDC2_SDCC_MCI_INT_MASKINT2_0_ADDR A:0x678640f0
y.create.l HWIO_SDC2_SDCC_MCI_INT_MASKINT2_1_ADDR A:0x678640f4
y.create.l HWIO_SDC2_SDCC_CHAR_CFG_ADDR A:0x678640fc
y.create.l HWIO_SDC2_SDCC_CHAR_CMD_ADDR A:0x67864100
y.create.l HWIO_SDC2_SDCC_CHAR_DATA_0_ADDR A:0x67864104
y.create.l HWIO_SDC2_SDCC_CHAR_DATA_1_ADDR A:0x67864108
y.create.l HWIO_SDC2_SDCC_CHAR_DATA_2_ADDR A:0x6786410c
y.create.l HWIO_SDC2_SDCC_CHAR_DATA_3_ADDR A:0x67864110
y.create.l HWIO_SDC2_SDCC_CHAR_DATA_4_ADDR A:0x67864114
y.create.l HWIO_SDC2_SDCC_CHAR_DATA_5_ADDR A:0x67864118
y.create.l HWIO_SDC2_SDCC_CHAR_DATA_6_ADDR A:0x6786411c
y.create.l HWIO_SDC2_SDCC_CHAR_DATA_7_ADDR A:0x67864120
y.create.l HWIO_SDC2_SDCC_DEBUG_REG_ADDR A:0x67864124
y.create.l HWIO_SDC2_SDCC_IP_CATALOG_ADDR A:0x67864128
y.create.l HWIO_SDC2_SDCC_QSB_VALUES_ADDR A:0x6786412c
y.create.l HWIO_SDC2_SDCC_QSB_AXI_VALUES_ADDR A:0x67864130
y.create.l HWIO_SDC2_SDCC_AXI_DATA_ERR_DBUG_ADDR A:0x67864134
y.create.l HWIO_SDC2_SDCC_T4_DLY_CTRL_ADDR A:0x67864138
y.create.l HWIO_SDC2_SDCC_T4_DLY_STAT_ADDR A:0x6786413c
y.create.l HWIO_SDC2_SDCC_CSR_CDC_CTLR_CFG0_ADDR A:0x67864140
y.create.l HWIO_SDC2_SDCC_CSR_CDC_CTLR_CFG1_ADDR A:0x67864144
y.create.l HWIO_SDC2_SDCC_CSR_CDC_CAL_TIMER_CFG0_ADDR A:0x67864148
y.create.l HWIO_SDC2_SDCC_CSR_CDC_CAL_TIMER_CFG1_ADDR A:0x6786414c
y.create.l HWIO_SDC2_SDCC_CSR_CDC_REFCOUNT_CFG_ADDR A:0x67864150
y.create.l HWIO_SDC2_SDCC_CSR_CDC_COARSE_CAL_CFG_ADDR A:0x67864154
y.create.l HWIO_SDC2_SDCC_CSR_CDC_RSVD_CFG_ADDR A:0x67864158
y.create.l HWIO_SDC2_SDCC_CSR_CDC_OFFSET_CFG_ADDR A:0x6786415c
y.create.l HWIO_SDC2_SDCC_CSR_CDC_DELAY_CFG_ADDR A:0x67864160
y.create.l HWIO_SDC2_SDCC_CSR_CDC_SW_MODE_CFG_ADDR A:0x67864164
y.create.l HWIO_SDC2_SDCC_CSR_CDC_TEST_CFG_ADDR A:0x67864168
y.create.l HWIO_SDC2_SDCC_CSR_CDC_SW_OVRD_CFG_ADDR A:0x6786416c
y.create.l HWIO_SDC2_SDCC_CSR_CDC_SLAVE_DDA_CFG_ADDR A:0x67864170
y.create.l HWIO_SDC2_SDCC_CSR_CDC_STATUS0_ADDR A:0x67864174
y.create.l HWIO_SDC2_SDCC_CSR_CDC_STATUS1_ADDR A:0x67864178
y.create.l HWIO_SDC2_SDCC_CSR_CDC_STATUS2_ADDR A:0x6786417c
y.create.l HWIO_SDC2_SDCC_CSR_CDC_STATUS3_ADDR A:0x67864180
y.create.l HWIO_SDC2_SDCC_CSR_CDC_STATUS4_ADDR A:0x67864184
y.create.l HWIO_SDC2_SDCC_CSR_CDC_GEN_CFG_ADDR A:0x67864188
y.create.l HWIO_SDC2_SDCC_CDC_AUTO_SW_CAL_CFG_ADDR A:0x6786418c
y.create.l HWIO_SDC2_SDCC_DDR200_STAT_ADDR A:0x67864190
y.create.l HWIO_SDC2_SDCC_DDR200_CFG_ADDR A:0x67864194
y.create.l HWIO_SDC2_SDCC_TIME_COUNT_CTRL_ADDR A:0x67864198
y.create.l HWIO_SDC2_SDCC_FLOW_CTRL_TIME_COUNT_ADDR A:0x6786419c
y.create.l HWIO_SDC2_SDCC_BUSY_TIME_COUNT_ADDR A:0x678641a0
y.create.l HWIO_SDC2_SDCC_DATA_TIME_COUNT_ADDR A:0x678641a4
y.create.l HWIO_SDC2_SDCC_CMD_TIME_COUNT_ADDR A:0x678641a8
y.create.l HWIO_SDC2_SDCC_MCI_DLL_CONFIG_2_ADDR A:0x678641ac
y.create.l HWIO_SDC2_SDCC_MCI_DDR_CONFIG_ADDR A:0x678641b0
y.create.l HWIO_SDC2_SDCC_MCI_FIFO_ALT0_ADDR A:0x67864400
y.create.l HWIO_SDC2_SDCC_MCI_FIFO_ALT1_ADDR A:0x67864404
y.create.l HWIO_SDC2_SDCC_MCI_FIFO_ALT2_ADDR A:0x67864408
y.create.l HWIO_SDC2_SDCC_MCI_FIFO_ALT3_ADDR A:0x6786440c
y.create.l HWIO_SDC2_SDCC_MCI_FIFO_ALT4_ADDR A:0x67864410
y.create.l HWIO_SDC2_SDCC_MCI_FIFO_ALT5_ADDR A:0x67864414
y.create.l HWIO_SDC2_SDCC_MCI_FIFO_ALT6_ADDR A:0x67864418
y.create.l HWIO_SDC2_SDCC_MCI_FIFO_ALT7_ADDR A:0x6786441c
y.create.l HWIO_SDC2_SDCC_MCI_FIFO_ALT8_ADDR A:0x67864420
y.create.l HWIO_SDC2_SDCC_MCI_FIFO_ALT9_ADDR A:0x67864424
y.create.l HWIO_SDC2_SDCC_HC_REG_0_2_ADDR A:0x67864900
y.create.l HWIO_SDC2_SDCC_HC_REG_4_6_ADDR A:0x67864904
y.create.l HWIO_SDC2_SDCC_HC_REG_8_A_ADDR A:0x67864908
y.create.l HWIO_SDC2_SDCC_HC_REG_C_E_ADDR A:0x6786490c
y.create.l HWIO_SDC2_SDCC_HC_REG_10_12_ADDR A:0x67864910
y.create.l HWIO_SDC2_SDCC_HC_REG_14_16_ADDR A:0x67864914
y.create.l HWIO_SDC2_SDCC_HC_REG_18_1A_ADDR A:0x67864918
y.create.l HWIO_SDC2_SDCC_HC_REG_1C_1E_ADDR A:0x6786491c
y.create.l HWIO_SDC2_SDCC_HC_REG_20_22_ADDR A:0x67864920
y.create.l HWIO_SDC2_SDCC_HC_REG_24_26_ADDR A:0x67864924
y.create.l HWIO_SDC2_SDCC_HC_REG_28_2A_ADDR A:0x67864928
y.create.l HWIO_SDC2_SDCC_HC_REG_2C_2E_ADDR A:0x6786492c
y.create.l HWIO_SDC2_SDCC_HC_REG_30_32_ADDR A:0x67864930
y.create.l HWIO_SDC2_SDCC_HC_REG_34_36_ADDR A:0x67864934
y.create.l HWIO_SDC2_SDCC_HC_REG_38_3A_ADDR A:0x67864938
y.create.l HWIO_SDC2_SDCC_HC_REG_3C_3E_ADDR A:0x6786493c
y.create.l HWIO_SDC2_SDCC_HC_REG_40_42_ADDR A:0x67864940
y.create.l HWIO_SDC2_SDCC_HC_REG_44_46_ADDR A:0x67864944
y.create.l HWIO_SDC2_SDCC_HC_REG_48_4A_ADDR A:0x67864948
y.create.l HWIO_SDC2_SDCC_HC_REG_50_52_ADDR A:0x67864950
y.create.l HWIO_SDC2_SDCC_HC_REG_54_56_ADDR A:0x67864954
y.create.l HWIO_SDC2_SDCC_HC_REG_58_5A_ADDR A:0x67864958
y.create.l HWIO_SDC2_SDCC_HC_REG_5C_5E_ADDR A:0x6786495c
y.create.l HWIO_SDC2_SDCC_HC_REG_60_62_ADDR A:0x67864960
y.create.l HWIO_SDC2_SDCC_HC_REG_64_66_ADDR A:0x67864964
y.create.l HWIO_SDC2_SDCC_HC_REG_68_6A_ADDR A:0x67864968
y.create.l HWIO_SDC2_SDCC_HC_REG_6C_6E_ADDR A:0x6786496c
y.create.l HWIO_SDC2_SDCC_HC_REG_E0_E2_ADDR A:0x678649e0
y.create.l HWIO_SDC2_SDCC_HC_REG_FC_FE_ADDR A:0x678649fc
y.create.l HWIO_SDC2_SDCC_HC_REG_DLL_CONFIG_ADDR A:0x67864a00
y.create.l HWIO_SDC2_SDCC_HC_REG_DLL_TEST_CTL_ADDR A:0x67864a04
y.create.l HWIO_SDC2_SDCC_HC_REG_DLL_STATUS_ADDR A:0x67864a08
y.create.l HWIO_SDC2_SDCC_HC_VENDOR_SPECIFIC_FUNC_ADDR A:0x67864a0c
y.create.l HWIO_SDC2_SDCC_HC_VENDOR_SPECIFIC_FUNC2_ADDR A:0x67864a10
y.create.l HWIO_SDC2_SDCC_HC_VENDOR_SPECIFIC_ADMA_ERR_ADDR0_ADDR A:0x67864a14
y.create.l HWIO_SDC2_SDCC_HC_VENDOR_SPECIFIC_ADMA_ERR_ADDR1_ADDR A:0x67864a18
y.create.l HWIO_SDC2_SDCC_HC_VENDOR_SPECIFIC_CAPABILITIES0_ADDR A:0x67864a1c
y.create.l HWIO_SDC2_SDCC_HC_VENDOR_SPECIFIC_CAPABILITIES1_ADDR A:0x67864a20
y.create.l HWIO_SDC2_SDCC_HC_VENDOR_SPECIFIC_T4_DLY_CTRL_ADDR A:0x67864a24
y.create.l HWIO_SDC2_SDCC_HC_VENDOR_SPECIFIC_T4_DLY_STAT_ADDR A:0x67864a28
y.create.l HWIO_SDC2_SDCC_HC_VENDOR_SPECIFIC_CSR_CDC_CTLR_CFG0_ADDR A:0x67864a30
y.create.l HWIO_SDC2_SDCC_HC_VENDOR_SPECIFIC_CSR_CDC_CTLR_CFG1_ADDR A:0x67864a34
y.create.l HWIO_SDC2_SDCC_HC_VENDOR_SPECIFIC_CSR_CDC_CAL_TIMER_CFG0_ADDR A:0x67864a38
y.create.l HWIO_SDC2_SDCC_HC_VENDOR_SPECIFIC_CSR_CDC_CAL_TIMER_CFG1_ADDR A:0x67864a3c
y.create.l HWIO_SDC2_SDCC_HC_VENDOR_SPECIFIC_CSR_CDC_REFCOUNT_CFG_ADDR A:0x67864a40
y.create.l HWIO_SDC2_SDCC_HC_VENDOR_SPECIFIC_CSR_CDC_COARSE_CAL_CFG_ADDR A:0x67864a44
y.create.l HWIO_SDC2_SDCC_HC_VENDOR_SPECIFIC_CSR_CDC_RSVD_CFG_ADDR A:0x67864a48
y.create.l HWIO_SDC2_SDCC_HC_VENDOR_SPECIFIC_CSR_CDC_OFFSET_CFG_ADDR A:0x67864a4c
y.create.l HWIO_SDC2_SDCC_HC_VENDOR_SPECIFIC_CSR_CDC_DELAY_CFG_ADDR A:0x67864a50
y.create.l HWIO_SDC2_SDCC_HC_VENDOR_SPECIFIC_CSR_CDC_SW_MODE_CFG_ADDR A:0x67864a54
y.create.l HWIO_SDC2_SDCC_HC_VENDOR_SPECIFIC_CSR_CDC_TEST_CFG_ADDR A:0x67864a58
y.create.l HWIO_SDC2_SDCC_HC_VENDOR_SPECIFIC_CSR_CDC_SW_OVRD_CFG_ADDR A:0x67864a5c
y.create.l HWIO_SDC2_SDCC_HC_VENDOR_SPECIFIC_CSR_CDC_SLAVE_DDA_CFG_ADDR A:0x67864a60
y.create.l HWIO_SDC2_SDCC_HC_VENDOR_SPECIFIC_CSR_CDC_STATUS0_ADDR A:0x67864a64
y.create.l HWIO_SDC2_SDCC_HC_VENDOR_SPECIFIC_CSR_CDC_STATUS1_ADDR A:0x67864a68
y.create.l HWIO_SDC2_SDCC_HC_VENDOR_SPECIFIC_CSR_CDC_STATUS2_ADDR A:0x67864a6c
y.create.l HWIO_SDC2_SDCC_HC_VENDOR_SPECIFIC_CSR_CDC_STATUS3_ADDR A:0x67864a70
y.create.l HWIO_SDC2_SDCC_HC_VENDOR_SPECIFIC_CSR_CDC_STATUS4_ADDR A:0x67864a74
y.create.l HWIO_SDC2_SDCC_HC_VENDOR_SPECIFIC_CSR_CDC_GEN_CFG_ADDR A:0x67864a78
y.create.l HWIO_SDC2_SDCC_HC_VENDOR_SPECIFIC_CDC_AUTO_SW_CAL_CFG_ADDR A:0x67864a7c
y.create.l HWIO_SDC2_SDCC_HC_VENDOR_SPECIFIC_DDR200_STAT_ADDR A:0x67864a80
y.create.l HWIO_SDC2_SDCC_HC_VENDOR_SPECIFIC_DDR200_CFG_ADDR A:0x67864a84
y.create.l HWIO_SDC2_SDCC_HC_VENDOR_SPECIFIC_TIME_COUNT_CTRL_ADDR A:0x67864a88
y.create.l HWIO_SDC2_SDCC_HC_VENDOR_SPECIFIC_FLOW_CTRL_TIME_COUNT_ADDR A:0x67864a8c
y.create.l HWIO_SDC2_SDCC_HC_VENDOR_SPECIFIC_BUSY_TIME_COUNT_ADDR A:0x67864a90
y.create.l HWIO_SDC2_SDCC_HC_VENDOR_SPECIFIC_DATA_TIME_COUNT_ADDR A:0x67864a94
y.create.l HWIO_SDC2_SDCC_HC_VENDOR_SPECIFIC_CMD_TIME_COUNT_ADDR A:0x67864a98
y.create.l HWIO_SDC2_SDCC_HC_VENDOR_SPECIFIC_ERR_INT_STS_ADDR A:0x67864a9c
y.create.l HWIO_SDC2_SDCC_HC_VENDOR_SPECIFIC_PWRCTL_STATUS_REG_ADDR A:0x67864aa0
y.create.l HWIO_SDC2_SDCC_HC_VENDOR_SPECIFIC_PWRCTL_MASK_REG_ADDR A:0x67864aa4
y.create.l HWIO_SDC2_SDCC_HC_VENDOR_SPECIFIC_PWRCTL_CLEAR_REG_ADDR A:0x67864aa8
y.create.l HWIO_SDC2_SDCC_HC_VENDOR_SPECIFIC_PWRCTL_CTL_REG_ADDR A:0x67864aac
y.create.l HWIO_SDC2_SDCC_HC_VENDOR_SPECIFIC_FUNC3_ADDR A:0x67864ab0
y.create.l HWIO_SDC2_SDCC_HC_REG_DLL_CONFIG_2_ADDR A:0x67864ab4
y.create.l HWIO_SDC2_SDCC_HC_REG_DDR_CONFIG_ADDR A:0x67864ab8
y.create.l HWIO_QFPROM_RAW_CRI_CM_PRIVATE0_ADDR A:0x600a0000
y.create.l HWIO_QFPROM_RAW_CRI_CM_PRIVATE1_ADDR A:0x600a0004
y.create.l HWIO_QFPROM_RAW_CRI_CM_PRIVATE2_ADDR A:0x600a0008
y.create.l HWIO_QFPROM_RAW_CRI_CM_PRIVATE3_ADDR A:0x600a000c
y.create.l HWIO_QFPROM_RAW_CRI_CM_PRIVATE4_ADDR A:0x600a0010
y.create.l HWIO_QFPROM_RAW_CRI_CM_PRIVATE5_ADDR A:0x600a0014
y.create.l HWIO_QFPROM_RAW_CRI_CM_PRIVATE6_ADDR A:0x600a0018
y.create.l HWIO_QFPROM_RAW_CRI_CM_PRIVATE7_ADDR A:0x600a001c
y.create.l HWIO_QFPROM_RAW_CRI_CM_PRIVATE8_ADDR A:0x600a0020
y.create.l HWIO_QFPROM_RAW_CRI_CM_PRIVATE9_ADDR A:0x600a0024
y.create.l HWIO_QFPROM_RAW_JTAG_ID_ADDR A:0x600a0120
y.create.l HWIO_QFPROM_RAW_PTE1_ADDR A:0x600a0124
y.create.l HWIO_QFPROM_RAW_SERIAL_NUM_ADDR A:0x600a0128
y.create.l HWIO_QFPROM_RAW_PTE2_ADDR A:0x600a012c
y.create.l HWIO_QFPROM_RAW_RD_WR_PERM_LSB_ADDR A:0x600a0130
y.create.l HWIO_QFPROM_RAW_RD_WR_PERM_MSB_ADDR A:0x600a0134
y.create.l HWIO_QFPROM_RAW_ANTI_ROLLBACK_1_LSB_ADDR A:0x600a0138
y.create.l HWIO_QFPROM_RAW_ANTI_ROLLBACK_1_MSB_ADDR A:0x600a013c
y.create.l HWIO_QFPROM_RAW_ANTI_ROLLBACK_2_LSB_ADDR A:0x600a0140
y.create.l HWIO_QFPROM_RAW_ANTI_ROLLBACK_2_MSB_ADDR A:0x600a0144
y.create.l HWIO_QFPROM_RAW_ANTI_ROLLBACK_3_LSB_ADDR A:0x600a0148
y.create.l HWIO_QFPROM_RAW_ANTI_ROLLBACK_3_MSB_ADDR A:0x600a014c
y.create.l HWIO_QFPROM_RAW_OEM_CONFIG_ROW0_LSB_ADDR A:0x600a0150
y.create.l HWIO_QFPROM_RAW_OEM_CONFIG_ROW0_MSB_ADDR A:0x600a0154
y.create.l HWIO_QFPROM_RAW_OEM_CONFIG_ROW1_LSB_ADDR A:0x600a0158
y.create.l HWIO_QFPROM_RAW_OEM_CONFIG_ROW1_MSB_ADDR A:0x600a015c
y.create.l HWIO_QFPROM_RAW_FEAT_CONFIG_ROW0_LSB_ADDR A:0x600a0160
y.create.l HWIO_QFPROM_RAW_FEAT_CONFIG_ROW0_MSB_ADDR A:0x600a0164
y.create.l HWIO_QFPROM_RAW_FEAT_CONFIG_ROW1_LSB_ADDR A:0x600a0168
y.create.l HWIO_QFPROM_RAW_FEAT_CONFIG_ROW1_MSB_ADDR A:0x600a016c
y.create.l HWIO_QFPROM_RAW_FEAT_CONFIG_ROW2_LSB_ADDR A:0x600a0170
y.create.l HWIO_QFPROM_RAW_FEAT_CONFIG_ROW2_MSB_ADDR A:0x600a0174
y.create.l HWIO_QFPROM_RAW_CM_FEAT_CONFIG_ROW0_LSB_ADDR A:0x600a0178
y.create.l HWIO_QFPROM_RAW_CM_FEAT_CONFIG_ROW0_MSB_ADDR A:0x600a017c
y.create.l HWIO_QFPROM_RAW_CM_FEAT_CONFIG_ROW1_LSB_ADDR A:0x600a0180
y.create.l HWIO_QFPROM_RAW_CM_FEAT_CONFIG_ROW1_MSB_ADDR A:0x600a0184
y.create.l HWIO_QFPROM_RAW_CM_FEAT_CONFIG_ROW2_LSB_ADDR A:0x600a0188
y.create.l HWIO_QFPROM_RAW_CM_FEAT_CONFIG_ROW2_MSB_ADDR A:0x600a018c
y.create.l HWIO_QFPROM_RAW_PRI_KEY_DERIVATION_KEY_ROW0_LSB_ADDR A:0x600a0190
y.create.l HWIO_QFPROM_RAW_PRI_KEY_DERIVATION_KEY_ROW1_LSB_ADDR A:0x600a0198
y.create.l HWIO_QFPROM_RAW_PRI_KEY_DERIVATION_KEY_ROW2_LSB_ADDR A:0x600a01a0
y.create.l HWIO_QFPROM_RAW_PRI_KEY_DERIVATION_KEY_ROW3_LSB_ADDR A:0x600a01a8
y.create.l HWIO_QFPROM_RAW_PRI_KEY_DERIVATION_KEY_ROW0_MSB_ADDR A:0x600a0194
y.create.l HWIO_QFPROM_RAW_PRI_KEY_DERIVATION_KEY_ROW1_MSB_ADDR A:0x600a019c
y.create.l HWIO_QFPROM_RAW_PRI_KEY_DERIVATION_KEY_ROW2_MSB_ADDR A:0x600a01a4
y.create.l HWIO_QFPROM_RAW_PRI_KEY_DERIVATION_KEY_ROW3_MSB_ADDR A:0x600a01ac
y.create.l HWIO_QFPROM_RAW_SEC_KEY_DERIVATION_KEY_ROW0_LSB_ADDR A:0x600a01b0
y.create.l HWIO_QFPROM_RAW_SEC_KEY_DERIVATION_KEY_ROW1_LSB_ADDR A:0x600a01b8
y.create.l HWIO_QFPROM_RAW_SEC_KEY_DERIVATION_KEY_ROW2_LSB_ADDR A:0x600a01c0
y.create.l HWIO_QFPROM_RAW_SEC_KEY_DERIVATION_KEY_ROW3_LSB_ADDR A:0x600a01c8
y.create.l HWIO_QFPROM_RAW_SEC_KEY_DERIVATION_KEY_ROW0_MSB_ADDR A:0x600a01b4
y.create.l HWIO_QFPROM_RAW_SEC_KEY_DERIVATION_KEY_ROW1_MSB_ADDR A:0x600a01bc
y.create.l HWIO_QFPROM_RAW_SEC_KEY_DERIVATION_KEY_ROW2_MSB_ADDR A:0x600a01c4
y.create.l HWIO_QFPROM_RAW_SEC_KEY_DERIVATION_KEY_ROW3_MSB_ADDR A:0x600a01cc
y.create.l HWIO_QFPROM_RAW_OEM_SEC_BOOT_ROW0_LSB_ADDR A:0x600a01d0
y.create.l HWIO_QFPROM_RAW_OEM_SEC_BOOT_ROW0_MSB_ADDR A:0x600a01d4
y.create.l HWIO_QFPROM_RAW_CALIB2_ROW0_LSB_ADDR A:0x600a01d8
y.create.l HWIO_QFPROM_RAW_CALIB2_ROW0_MSB_ADDR A:0x600a01dc
y.create.l HWIO_QFPROM_RAW_PK_HASH_ROW0_LSB_ADDR A:0x600a01e0
y.create.l HWIO_QFPROM_RAW_PK_HASH_ROW1_LSB_ADDR A:0x600a01e8
y.create.l HWIO_QFPROM_RAW_PK_HASH_ROW2_LSB_ADDR A:0x600a01f0
y.create.l HWIO_QFPROM_RAW_PK_HASH_ROW3_LSB_ADDR A:0x600a01f8
y.create.l HWIO_QFPROM_RAW_PK_HASH_ROW0_MSB_ADDR A:0x600a01e4
y.create.l HWIO_QFPROM_RAW_PK_HASH_ROW1_MSB_ADDR A:0x600a01ec
y.create.l HWIO_QFPROM_RAW_PK_HASH_ROW2_MSB_ADDR A:0x600a01f4
y.create.l HWIO_QFPROM_RAW_PK_HASH_ROW3_MSB_ADDR A:0x600a01fc
y.create.l HWIO_QFPROM_RAW_PK_HASH_ROW4_LSB_ADDR A:0x600a0200
y.create.l HWIO_QFPROM_RAW_PK_HASH_ROW4_MSB_ADDR A:0x600a0204
y.create.l HWIO_QFPROM_RAW_CALIB_ROW0_LSB_ADDR A:0x600a0208
y.create.l HWIO_QFPROM_RAW_CALIB_ROW0_MSB_ADDR A:0x600a020c
y.create.l HWIO_QFPROM_RAW_CALIB_ROW1_LSB_ADDR A:0x600a0210
y.create.l HWIO_QFPROM_RAW_CALIB_ROW1_MSB_ADDR A:0x600a0214
y.create.l HWIO_QFPROM_RAW_CALIB_ROW2_LSB_ADDR A:0x600a0218
y.create.l HWIO_QFPROM_RAW_CALIB_ROW2_MSB_ADDR A:0x600a021c
y.create.l HWIO_QFPROM_RAW_CALIB_ROW3_LSB_ADDR A:0x600a0220
y.create.l HWIO_QFPROM_RAW_CALIB_ROW3_MSB_ADDR A:0x600a0224
y.create.l HWIO_QFPROM_RAW_CALIB_ROW4_LSB_ADDR A:0x600a0228
y.create.l HWIO_QFPROM_RAW_CALIB_ROW4_MSB_ADDR A:0x600a022c
y.create.l HWIO_QFPROM_RAW_CALIB_ROW5_LSB_ADDR A:0x600a0230
y.create.l HWIO_QFPROM_RAW_CALIB_ROW5_MSB_ADDR A:0x600a0234
y.create.l HWIO_QFPROM_RAW_CALIB_ROW6_LSB_ADDR A:0x600a0238
y.create.l HWIO_QFPROM_RAW_CALIB_ROW6_MSB_ADDR A:0x600a023c
y.create.l HWIO_QFPROM_RAW_CALIB_ROW7_LSB_ADDR A:0x600a0240
y.create.l HWIO_QFPROM_RAW_CALIB_ROW7_MSB_ADDR A:0x600a0244
y.create.l HWIO_QFPROM_RAW_CALIB_ROW8_LSB_ADDR A:0x600a0248
y.create.l HWIO_QFPROM_RAW_CALIB_ROW8_MSB_ADDR A:0x600a024c
y.create.l HWIO_QFPROM_RAW_CALIB_ROW9_LSB_ADDR A:0x600a0250
y.create.l HWIO_QFPROM_RAW_CALIB_ROW9_MSB_ADDR A:0x600a0254
y.create.l HWIO_QFPROM_RAW_MEM_CONFIG_ROW0_LSB_ADDR A:0x600a0258
y.create.l HWIO_QFPROM_RAW_MEM_CONFIG_ROW1_LSB_ADDR A:0x600a0260
y.create.l HWIO_QFPROM_RAW_MEM_CONFIG_ROW2_LSB_ADDR A:0x600a0268
y.create.l HWIO_QFPROM_RAW_MEM_CONFIG_ROW3_LSB_ADDR A:0x600a0270
y.create.l HWIO_QFPROM_RAW_MEM_CONFIG_ROW4_LSB_ADDR A:0x600a0278
y.create.l HWIO_QFPROM_RAW_MEM_CONFIG_ROW5_LSB_ADDR A:0x600a0280
y.create.l HWIO_QFPROM_RAW_MEM_CONFIG_ROW6_LSB_ADDR A:0x600a0288
y.create.l HWIO_QFPROM_RAW_MEM_CONFIG_ROW7_LSB_ADDR A:0x600a0290
y.create.l HWIO_QFPROM_RAW_MEM_CONFIG_ROW8_LSB_ADDR A:0x600a0298
y.create.l HWIO_QFPROM_RAW_MEM_CONFIG_ROW0_MSB_ADDR A:0x600a025c
y.create.l HWIO_QFPROM_RAW_MEM_CONFIG_ROW1_MSB_ADDR A:0x600a0264
y.create.l HWIO_QFPROM_RAW_MEM_CONFIG_ROW2_MSB_ADDR A:0x600a026c
y.create.l HWIO_QFPROM_RAW_MEM_CONFIG_ROW3_MSB_ADDR A:0x600a0274
y.create.l HWIO_QFPROM_RAW_MEM_CONFIG_ROW4_MSB_ADDR A:0x600a027c
y.create.l HWIO_QFPROM_RAW_MEM_CONFIG_ROW5_MSB_ADDR A:0x600a0284
y.create.l HWIO_QFPROM_RAW_MEM_CONFIG_ROW6_MSB_ADDR A:0x600a028c
y.create.l HWIO_QFPROM_RAW_MEM_CONFIG_ROW7_MSB_ADDR A:0x600a0294
y.create.l HWIO_QFPROM_RAW_MEM_CONFIG_ROW8_MSB_ADDR A:0x600a029c
y.create.l HWIO_QFPROM_RAW_MEM_CONFIG_ROW9_LSB_ADDR A:0x600a02a0
y.create.l HWIO_QFPROM_RAW_MEM_CONFIG_ROW9_MSB_ADDR A:0x600a02a4
y.create.l HWIO_QFPROM_RAW_MEM_CONFIG_ROW10_LSB_ADDR A:0x600a02a8
y.create.l HWIO_QFPROM_RAW_MEM_CONFIG_ROW10_MSB_ADDR A:0x600a02ac
y.create.l HWIO_QFPROM_RAW_ROM_PATCH_ROW0_LSB_ADDR A:0x600a02b0
y.create.l HWIO_QFPROM_RAW_ROM_PATCH_ROW1_LSB_ADDR A:0x600a02b8
y.create.l HWIO_QFPROM_RAW_ROM_PATCH_ROW2_LSB_ADDR A:0x600a02c0
y.create.l HWIO_QFPROM_RAW_ROM_PATCH_ROW3_LSB_ADDR A:0x600a02c8
y.create.l HWIO_QFPROM_RAW_ROM_PATCH_ROW4_LSB_ADDR A:0x600a02d0
y.create.l HWIO_QFPROM_RAW_ROM_PATCH_ROW5_LSB_ADDR A:0x600a02d8
y.create.l HWIO_QFPROM_RAW_ROM_PATCH_ROW6_LSB_ADDR A:0x600a02e0
y.create.l HWIO_QFPROM_RAW_ROM_PATCH_ROW7_LSB_ADDR A:0x600a02e8
y.create.l HWIO_QFPROM_RAW_ROM_PATCH_ROW8_LSB_ADDR A:0x600a02f0
y.create.l HWIO_QFPROM_RAW_ROM_PATCH_ROW9_LSB_ADDR A:0x600a02f8
y.create.l HWIO_QFPROM_RAW_ROM_PATCH_ROW0_MSB_ADDR A:0x600a02b4
y.create.l HWIO_QFPROM_RAW_ROM_PATCH_ROW1_MSB_ADDR A:0x600a02bc
y.create.l HWIO_QFPROM_RAW_ROM_PATCH_ROW2_MSB_ADDR A:0x600a02c4
y.create.l HWIO_QFPROM_RAW_ROM_PATCH_ROW3_MSB_ADDR A:0x600a02cc
y.create.l HWIO_QFPROM_RAW_ROM_PATCH_ROW4_MSB_ADDR A:0x600a02d4
y.create.l HWIO_QFPROM_RAW_ROM_PATCH_ROW5_MSB_ADDR A:0x600a02dc
y.create.l HWIO_QFPROM_RAW_ROM_PATCH_ROW6_MSB_ADDR A:0x600a02e4
y.create.l HWIO_QFPROM_RAW_ROM_PATCH_ROW7_MSB_ADDR A:0x600a02ec
y.create.l HWIO_QFPROM_RAW_ROM_PATCH_ROW8_MSB_ADDR A:0x600a02f4
y.create.l HWIO_QFPROM_RAW_ROM_PATCH_ROW9_MSB_ADDR A:0x600a02fc
y.create.l HWIO_QFPROM_RAW_FEC_EN_LSB_ADDR A:0x600a03b0
y.create.l HWIO_QFPROM_RAW_FEC_EN_MSB_ADDR A:0x600a03b4
y.create.l HWIO_QFPROM_RAW_SPARE_REG18_LSB_ADDR A:0x600a03b8
y.create.l HWIO_QFPROM_RAW_SPARE_REG18_MSB_ADDR A:0x600a03bc
y.create.l HWIO_QFPROM_RAW_SPARE_REG19_LSB_ADDR A:0x600a03c0
y.create.l HWIO_QFPROM_RAW_SPARE_REG19_MSB_ADDR A:0x600a03c4
y.create.l HWIO_QFPROM_RAW_SPARE_REG20_LSB_ADDR A:0x600a03c8
y.create.l HWIO_QFPROM_RAW_SPARE_REG20_MSB_ADDR A:0x600a03cc
y.create.l HWIO_QFPROM_RAW_SPARE_REG21_LSB_ADDR A:0x600a03d0
y.create.l HWIO_QFPROM_RAW_SPARE_REG21_MSB_ADDR A:0x600a03d4
y.create.l HWIO_QFPROM_RAW_SPARE_REG22_LSB_ADDR A:0x600a03d8
y.create.l HWIO_QFPROM_RAW_SPARE_REG22_MSB_ADDR A:0x600a03dc
y.create.l HWIO_QFPROM_RAW_SPARE_REG23_LSB_ADDR A:0x600a03e0
y.create.l HWIO_QFPROM_RAW_SPARE_REG23_MSB_ADDR A:0x600a03e4
y.create.l HWIO_QFPROM_RAW_SPARE_REG24_LSB_ADDR A:0x600a03e8
y.create.l HWIO_QFPROM_RAW_SPARE_REG24_MSB_ADDR A:0x600a03ec
y.create.l HWIO_QFPROM_RAW_SPARE_REG25_LSB_ADDR A:0x600a03f0
y.create.l HWIO_QFPROM_RAW_SPARE_REG25_MSB_ADDR A:0x600a03f4
y.create.l HWIO_QFPROM_RAW_SPARE_REG26_LSB_ADDR A:0x600a03f8
y.create.l HWIO_QFPROM_RAW_SPARE_REG26_MSB_ADDR A:0x600a03fc
y.create.l HWIO_QFPROM_RAW_ACC_PRIVATE0_ADDR A:0x600a0800
y.create.l HWIO_QFPROM_RAW_ACC_PRIVATE1_ADDR A:0x600a0804
y.create.l HWIO_QFPROM_RAW_ACC_PRIVATE2_ADDR A:0x600a0808
y.create.l HWIO_QFPROM_RAW_ACC_PRIVATE3_ADDR A:0x600a080c
y.create.l HWIO_QFPROM_RAW_ACC_PRIVATE4_ADDR A:0x600a0810
y.create.l HWIO_QFPROM_RAW_ACC_PRIVATE5_ADDR A:0x600a0814
y.create.l HWIO_QFPROM_RAW_ACC_PRIVATE6_ADDR A:0x600a0818
y.create.l HWIO_QFPROM_RAW_ACC_PRIVATE7_ADDR A:0x600a081c
y.create.l HWIO_QFPROM_RAW_ACC_PRIVATE8_ADDR A:0x600a0820
y.create.l HWIO_QFPROM_RAW_ACC_PRIVATE9_ADDR A:0x600a0824
y.create.l HWIO_ACC_IR_ADDR A:0x600a2000
y.create.l HWIO_ACC_DR_ADDR A:0x600a2004
y.create.l HWIO_ACC_VERID_ADDR A:0x600a2008
y.create.l HWIO_ACC_FEATSET0_ADDR A:0x600a2010
y.create.l HWIO_ACC_FEATSET1_ADDR A:0x600a2014
y.create.l HWIO_ACC_FEATSET2_ADDR A:0x600a2018
y.create.l HWIO_ACC_FEATSET3_ADDR A:0x600a201c
y.create.l HWIO_ACC_FEATSET4_ADDR A:0x600a2020
y.create.l HWIO_ACC_FEATSET5_ADDR A:0x600a2024
y.create.l HWIO_ACC_FEATSET6_ADDR A:0x600a2028
y.create.l HWIO_ACC_FEATSET7_ADDR A:0x600a202c
y.create.l HWIO_ACC_STATE_ADDR A:0x600a2038
y.create.l HWIO_QFPROM_BLOW_TIMER_ADDR A:0x600a203c
y.create.l HWIO_QFPROM_TEST_CTRL_ADDR A:0x600a2040
y.create.l HWIO_QFPROM_ACCEL_ADDR A:0x600a2044
y.create.l HWIO_QFPROM_BLOW_STATUS_ADDR A:0x600a2048
y.create.l HWIO_QFPROM_ROM_ERROR_ADDR A:0x600a204c
y.create.l HWIO_QFPROM_BIST_CTRL_ADDR A:0x600a2050
y.create.l HWIO_QFPROM_BIST_ERROR_ADDR A:0x600a2054
y.create.l HWIO_QFPROM_HASH_SIGNATURE0_ADDR A:0x600a2060
y.create.l HWIO_QFPROM_HASH_SIGNATURE1_ADDR A:0x600a2064
y.create.l HWIO_QFPROM_HASH_SIGNATURE2_ADDR A:0x600a2068
y.create.l HWIO_QFPROM_HASH_SIGNATURE3_ADDR A:0x600a206c
y.create.l HWIO_QFPROM_HASH_SIGNATURE4_ADDR A:0x600a2070
y.create.l HWIO_QFPROM_HASH_SIGNATURE5_ADDR A:0x600a2074
y.create.l HWIO_QFPROM_HASH_SIGNATURE6_ADDR A:0x600a2078
y.create.l HWIO_QFPROM_HASH_SIGNATURE7_ADDR A:0x600a207c
y.create.l HWIO_HW_KEY_STATUS_ADDR A:0x600a2080
y.create.l HWIO_RESET_JDR_STATUS_ADDR A:0x600a2084
y.create.l HWIO_FEC_ESR_ADDR A:0x600a2090
y.create.l HWIO_FEC_EAR_ADDR A:0x600a2094
y.create.l HWIO_QFPROM0_MATCH_STATUS_ADDR A:0x600a2098
y.create.l HWIO_QFPROM1_MATCH_STATUS_ADDR A:0x600a209c
y.create.l HWIO_FEAT_PROV_OUT0_ADDR A:0x600a20a0
y.create.l HWIO_FEAT_PROV_OUT1_ADDR A:0x600a20a4
y.create.l HWIO_FEAT_PROV_OUT2_ADDR A:0x600a20a8
y.create.l HWIO_FEAT_PROV_OUT3_ADDR A:0x600a20ac
y.create.l HWIO_SEC_CTRL_MISC_CONFIG_STATUS0_ADDR A:0x600a20b0
y.create.l HWIO_SEC_CTRL_MISC_CONFIG_STATUS1_ADDR A:0x600a20b4
y.create.l HWIO_SEC_CTRL_MISC_CONFIG_STATUS2_ADDR A:0x600a20b8
y.create.l HWIO_SEC_CTRL_MISC_CONFIG_STATUS3_ADDR A:0x600a20bc
y.create.l HWIO_QFPROM_CORR_CRI_CM_PRIVATE0_ADDR A:0x600a4000
y.create.l HWIO_QFPROM_CORR_CRI_CM_PRIVATE1_ADDR A:0x600a4004
y.create.l HWIO_QFPROM_CORR_CRI_CM_PRIVATE2_ADDR A:0x600a4008
y.create.l HWIO_QFPROM_CORR_CRI_CM_PRIVATE3_ADDR A:0x600a400c
y.create.l HWIO_QFPROM_CORR_CRI_CM_PRIVATE4_ADDR A:0x600a4010
y.create.l HWIO_QFPROM_CORR_CRI_CM_PRIVATE5_ADDR A:0x600a4014
y.create.l HWIO_QFPROM_CORR_CRI_CM_PRIVATE6_ADDR A:0x600a4018
y.create.l HWIO_QFPROM_CORR_CRI_CM_PRIVATE7_ADDR A:0x600a401c
y.create.l HWIO_QFPROM_CORR_CRI_CM_PRIVATE8_ADDR A:0x600a4020
y.create.l HWIO_QFPROM_CORR_CRI_CM_PRIVATE9_ADDR A:0x600a4024
y.create.l HWIO_QFPROM_CORR_JTAG_ID_ADDR A:0x600a4120
y.create.l HWIO_QFPROM_CORR_PTE1_ADDR A:0x600a4124
y.create.l HWIO_QFPROM_CORR_SERIAL_NUM_ADDR A:0x600a4128
y.create.l HWIO_QFPROM_CORR_PTE2_ADDR A:0x600a412c
y.create.l HWIO_QFPROM_CORR_RD_WR_PERM_LSB_ADDR A:0x600a4130
y.create.l HWIO_QFPROM_CORR_RD_WR_PERM_MSB_ADDR A:0x600a4134
y.create.l HWIO_QFPROM_CORR_ANTI_ROLLBACK_1_LSB_ADDR A:0x600a4138
y.create.l HWIO_QFPROM_CORR_ANTI_ROLLBACK_1_MSB_ADDR A:0x600a413c
y.create.l HWIO_QFPROM_CORR_ANTI_ROLLBACK_2_LSB_ADDR A:0x600a4140
y.create.l HWIO_QFPROM_CORR_ANTI_ROLLBACK_2_MSB_ADDR A:0x600a4144
y.create.l HWIO_QFPROM_CORR_ANTI_ROLLBACK_3_LSB_ADDR A:0x600a4148
y.create.l HWIO_QFPROM_CORR_ANTI_ROLLBACK_3_MSB_ADDR A:0x600a414c
y.create.l HWIO_QFPROM_CORR_OEM_CONFIG_ROW0_LSB_ADDR A:0x600a4150
y.create.l HWIO_QFPROM_CORR_OEM_CONFIG_ROW0_MSB_ADDR A:0x600a4154
y.create.l HWIO_QFPROM_CORR_OEM_CONFIG_ROW1_LSB_ADDR A:0x600a4158
y.create.l HWIO_QFPROM_CORR_OEM_CONFIG_ROW1_MSB_ADDR A:0x600a415c
y.create.l HWIO_QFPROM_CORR_FEAT_CONFIG_ROW0_LSB_ADDR A:0x600a4160
y.create.l HWIO_QFPROM_CORR_FEAT_CONFIG_ROW0_MSB_ADDR A:0x600a4164
y.create.l HWIO_QFPROM_CORR_FEAT_CONFIG_ROW1_LSB_ADDR A:0x600a4168
y.create.l HWIO_QFPROM_CORR_FEAT_CONFIG_ROW1_MSB_ADDR A:0x600a416c
y.create.l HWIO_QFPROM_CORR_FEAT_CONFIG_ROW2_LSB_ADDR A:0x600a4170
y.create.l HWIO_QFPROM_CORR_FEAT_CONFIG_ROW2_MSB_ADDR A:0x600a4174
y.create.l HWIO_QFPROM_CORR_CM_FEAT_CONFIG_ROW0_LSB_ADDR A:0x600a4178
y.create.l HWIO_QFPROM_CORR_CM_FEAT_CONFIG_ROW0_MSB_ADDR A:0x600a417c
y.create.l HWIO_QFPROM_CORR_CM_FEAT_CONFIG_ROW1_LSB_ADDR A:0x600a4180
y.create.l HWIO_QFPROM_CORR_CM_FEAT_CONFIG_ROW1_MSB_ADDR A:0x600a4184
y.create.l HWIO_QFPROM_CORR_CM_FEAT_CONFIG_ROW2_LSB_ADDR A:0x600a4188
y.create.l HWIO_QFPROM_CORR_CM_FEAT_CONFIG_ROW2_MSB_ADDR A:0x600a418c
y.create.l HWIO_QFPROM_CORR_PRI_KEY_DERIVATION_KEY_ROW0_LSB_ADDR A:0x600a4190
y.create.l HWIO_QFPROM_CORR_PRI_KEY_DERIVATION_KEY_ROW1_LSB_ADDR A:0x600a4198
y.create.l HWIO_QFPROM_CORR_PRI_KEY_DERIVATION_KEY_ROW2_LSB_ADDR A:0x600a41a0
y.create.l HWIO_QFPROM_CORR_PRI_KEY_DERIVATION_KEY_ROW3_LSB_ADDR A:0x600a41a8
y.create.l HWIO_QFPROM_CORR_PRI_KEY_DERIVATION_KEY_ROW0_MSB_ADDR A:0x600a4194
y.create.l HWIO_QFPROM_CORR_PRI_KEY_DERIVATION_KEY_ROW1_MSB_ADDR A:0x600a419c
y.create.l HWIO_QFPROM_CORR_PRI_KEY_DERIVATION_KEY_ROW2_MSB_ADDR A:0x600a41a4
y.create.l HWIO_QFPROM_CORR_PRI_KEY_DERIVATION_KEY_ROW3_MSB_ADDR A:0x600a41ac
y.create.l HWIO_QFPROM_CORR_SEC_KEY_DERIVATION_KEY_ROW0_LSB_ADDR A:0x600a41b0
y.create.l HWIO_QFPROM_CORR_SEC_KEY_DERIVATION_KEY_ROW1_LSB_ADDR A:0x600a41b8
y.create.l HWIO_QFPROM_CORR_SEC_KEY_DERIVATION_KEY_ROW2_LSB_ADDR A:0x600a41c0
y.create.l HWIO_QFPROM_CORR_SEC_KEY_DERIVATION_KEY_ROW3_LSB_ADDR A:0x600a41c8
y.create.l HWIO_QFPROM_CORR_SEC_KEY_DERIVATION_KEY_ROW0_MSB_ADDR A:0x600a41b4
y.create.l HWIO_QFPROM_CORR_SEC_KEY_DERIVATION_KEY_ROW1_MSB_ADDR A:0x600a41bc
y.create.l HWIO_QFPROM_CORR_SEC_KEY_DERIVATION_KEY_ROW2_MSB_ADDR A:0x600a41c4
y.create.l HWIO_QFPROM_CORR_SEC_KEY_DERIVATION_KEY_ROW3_MSB_ADDR A:0x600a41cc
y.create.l HWIO_QFPROM_CORR_OEM_SEC_BOOT_ROW0_LSB_ADDR A:0x600a41d0
y.create.l HWIO_QFPROM_CORR_OEM_SEC_BOOT_ROW0_MSB_ADDR A:0x600a41d4
y.create.l HWIO_QFPROM_CORR_CALIB2_ROW0_LSB_ADDR A:0x600a41d8
y.create.l HWIO_QFPROM_CORR_CALIB2_ROW0_MSB_ADDR A:0x600a41dc
y.create.l HWIO_QFPROM_CORR_PK_HASH_ROW0_LSB_ADDR A:0x600a41e0
y.create.l HWIO_QFPROM_CORR_PK_HASH_ROW1_LSB_ADDR A:0x600a41e8
y.create.l HWIO_QFPROM_CORR_PK_HASH_ROW2_LSB_ADDR A:0x600a41f0
y.create.l HWIO_QFPROM_CORR_PK_HASH_ROW3_LSB_ADDR A:0x600a41f8
y.create.l HWIO_QFPROM_CORR_PK_HASH_ROW0_MSB_ADDR A:0x600a41e4
y.create.l HWIO_QFPROM_CORR_PK_HASH_ROW1_MSB_ADDR A:0x600a41ec
y.create.l HWIO_QFPROM_CORR_PK_HASH_ROW2_MSB_ADDR A:0x600a41f4
y.create.l HWIO_QFPROM_CORR_PK_HASH_ROW3_MSB_ADDR A:0x600a41fc
y.create.l HWIO_QFPROM_CORR_PK_HASH_ROW4_LSB_ADDR A:0x600a4200
y.create.l HWIO_QFPROM_CORR_PK_HASH_ROW4_MSB_ADDR A:0x600a4204
y.create.l HWIO_QFPROM_CORR_CALIB_ROW0_LSB_ADDR A:0x600a4208
y.create.l HWIO_QFPROM_CORR_CALIB_ROW0_MSB_ADDR A:0x600a420c
y.create.l HWIO_QFPROM_CORR_CALIB_ROW1_LSB_ADDR A:0x600a4210
y.create.l HWIO_QFPROM_CORR_CALIB_ROW1_MSB_ADDR A:0x600a4214
y.create.l HWIO_QFPROM_CORR_CALIB_ROW2_LSB_ADDR A:0x600a4218
y.create.l HWIO_QFPROM_CORR_CALIB_ROW2_MSB_ADDR A:0x600a421c
y.create.l HWIO_QFPROM_CORR_CALIB_ROW3_LSB_ADDR A:0x600a4220
y.create.l HWIO_QFPROM_CORR_CALIB_ROW3_MSB_ADDR A:0x600a4224
y.create.l HWIO_QFPROM_CORR_CALIB_ROW4_LSB_ADDR A:0x600a4228
y.create.l HWIO_QFPROM_CORR_CALIB_ROW4_MSB_ADDR A:0x600a422c
y.create.l HWIO_QFPROM_CORR_CALIB_ROW5_LSB_ADDR A:0x600a4230
y.create.l HWIO_QFPROM_CORR_CALIB_ROW5_MSB_ADDR A:0x600a4234
y.create.l HWIO_QFPROM_CORR_CALIB_ROW6_LSB_ADDR A:0x600a4238
y.create.l HWIO_QFPROM_CORR_CALIB_ROW6_MSB_ADDR A:0x600a423c
y.create.l HWIO_QFPROM_CORR_CALIB_ROW7_LSB_ADDR A:0x600a4240
y.create.l HWIO_QFPROM_CORR_CALIB_ROW7_MSB_ADDR A:0x600a4244
y.create.l HWIO_QFPROM_CORR_CALIB_ROW8_LSB_ADDR A:0x600a4248
y.create.l HWIO_QFPROM_CORR_CALIB_ROW8_MSB_ADDR A:0x600a424c
y.create.l HWIO_QFPROM_CORR_CALIB_ROW9_LSB_ADDR A:0x600a4250
y.create.l HWIO_QFPROM_CORR_CALIB_ROW9_MSB_ADDR A:0x600a4254
y.create.l HWIO_QFPROM_CORR_MEM_CONFIG_ROW0_LSB_ADDR A:0x600a4258
y.create.l HWIO_QFPROM_CORR_MEM_CONFIG_ROW1_LSB_ADDR A:0x600a4260
y.create.l HWIO_QFPROM_CORR_MEM_CONFIG_ROW2_LSB_ADDR A:0x600a4268
y.create.l HWIO_QFPROM_CORR_MEM_CONFIG_ROW3_LSB_ADDR A:0x600a4270
y.create.l HWIO_QFPROM_CORR_MEM_CONFIG_ROW4_LSB_ADDR A:0x600a4278
y.create.l HWIO_QFPROM_CORR_MEM_CONFIG_ROW5_LSB_ADDR A:0x600a4280
y.create.l HWIO_QFPROM_CORR_MEM_CONFIG_ROW6_LSB_ADDR A:0x600a4288
y.create.l HWIO_QFPROM_CORR_MEM_CONFIG_ROW7_LSB_ADDR A:0x600a4290
y.create.l HWIO_QFPROM_CORR_MEM_CONFIG_ROW8_LSB_ADDR A:0x600a4298
y.create.l HWIO_QFPROM_CORR_MEM_CONFIG_ROW0_MSB_ADDR A:0x600a425c
y.create.l HWIO_QFPROM_CORR_MEM_CONFIG_ROW1_MSB_ADDR A:0x600a4264
y.create.l HWIO_QFPROM_CORR_MEM_CONFIG_ROW2_MSB_ADDR A:0x600a426c
y.create.l HWIO_QFPROM_CORR_MEM_CONFIG_ROW3_MSB_ADDR A:0x600a4274
y.create.l HWIO_QFPROM_CORR_MEM_CONFIG_ROW4_MSB_ADDR A:0x600a427c
y.create.l HWIO_QFPROM_CORR_MEM_CONFIG_ROW5_MSB_ADDR A:0x600a4284
y.create.l HWIO_QFPROM_CORR_MEM_CONFIG_ROW6_MSB_ADDR A:0x600a428c
y.create.l HWIO_QFPROM_CORR_MEM_CONFIG_ROW7_MSB_ADDR A:0x600a4294
y.create.l HWIO_QFPROM_CORR_MEM_CONFIG_ROW8_MSB_ADDR A:0x600a429c
y.create.l HWIO_QFPROM_CORR_MEM_CONFIG_ROW9_LSB_ADDR A:0x600a42a0
y.create.l HWIO_QFPROM_CORR_MEM_CONFIG_ROW9_MSB_ADDR A:0x600a42a4
y.create.l HWIO_QFPROM_CORR_MEM_CONFIG_ROW10_LSB_ADDR A:0x600a42a8
y.create.l HWIO_QFPROM_CORR_MEM_CONFIG_ROW10_MSB_ADDR A:0x600a42ac
y.create.l HWIO_QFPROM_CORR_ROM_PATCH_ROW0_LSB_ADDR A:0x600a42b0
y.create.l HWIO_QFPROM_CORR_ROM_PATCH_ROW1_LSB_ADDR A:0x600a42b8
y.create.l HWIO_QFPROM_CORR_ROM_PATCH_ROW2_LSB_ADDR A:0x600a42c0
y.create.l HWIO_QFPROM_CORR_ROM_PATCH_ROW3_LSB_ADDR A:0x600a42c8
y.create.l HWIO_QFPROM_CORR_ROM_PATCH_ROW4_LSB_ADDR A:0x600a42d0
y.create.l HWIO_QFPROM_CORR_ROM_PATCH_ROW5_LSB_ADDR A:0x600a42d8
y.create.l HWIO_QFPROM_CORR_ROM_PATCH_ROW6_LSB_ADDR A:0x600a42e0
y.create.l HWIO_QFPROM_CORR_ROM_PATCH_ROW7_LSB_ADDR A:0x600a42e8
y.create.l HWIO_QFPROM_CORR_ROM_PATCH_ROW8_LSB_ADDR A:0x600a42f0
y.create.l HWIO_QFPROM_CORR_ROM_PATCH_ROW9_LSB_ADDR A:0x600a42f8
y.create.l HWIO_QFPROM_CORR_ROM_PATCH_ROW0_MSB_ADDR A:0x600a42b4
y.create.l HWIO_QFPROM_CORR_ROM_PATCH_ROW1_MSB_ADDR A:0x600a42bc
y.create.l HWIO_QFPROM_CORR_ROM_PATCH_ROW2_MSB_ADDR A:0x600a42c4
y.create.l HWIO_QFPROM_CORR_ROM_PATCH_ROW3_MSB_ADDR A:0x600a42cc
y.create.l HWIO_QFPROM_CORR_ROM_PATCH_ROW4_MSB_ADDR A:0x600a42d4
y.create.l HWIO_QFPROM_CORR_ROM_PATCH_ROW5_MSB_ADDR A:0x600a42dc
y.create.l HWIO_QFPROM_CORR_ROM_PATCH_ROW6_MSB_ADDR A:0x600a42e4
y.create.l HWIO_QFPROM_CORR_ROM_PATCH_ROW7_MSB_ADDR A:0x600a42ec
y.create.l HWIO_QFPROM_CORR_ROM_PATCH_ROW8_MSB_ADDR A:0x600a42f4
y.create.l HWIO_QFPROM_CORR_ROM_PATCH_ROW9_MSB_ADDR A:0x600a42fc
y.create.l HWIO_QFPROM_CORR_FEC_EN_LSB_ADDR A:0x600a43b0
y.create.l HWIO_QFPROM_CORR_FEC_EN_MSB_ADDR A:0x600a43b4
y.create.l HWIO_QFPROM_CORR_SPARE_REG18_LSB_ADDR A:0x600a43b8
y.create.l HWIO_QFPROM_CORR_SPARE_REG18_MSB_ADDR A:0x600a43bc
y.create.l HWIO_QFPROM_CORR_SPARE_REG19_LSB_ADDR A:0x600a43c0
y.create.l HWIO_QFPROM_CORR_SPARE_REG19_MSB_ADDR A:0x600a43c4
y.create.l HWIO_QFPROM_CORR_SPARE_REG20_LSB_ADDR A:0x600a43c8
y.create.l HWIO_QFPROM_CORR_SPARE_REG20_MSB_ADDR A:0x600a43cc
y.create.l HWIO_QFPROM_CORR_SPARE_REG21_LSB_ADDR A:0x600a43d0
y.create.l HWIO_QFPROM_CORR_SPARE_REG21_MSB_ADDR A:0x600a43d4
y.create.l HWIO_QFPROM_CORR_SPARE_REG22_LSB_ADDR A:0x600a43d8
y.create.l HWIO_QFPROM_CORR_SPARE_REG22_MSB_ADDR A:0x600a43dc
y.create.l HWIO_QFPROM_CORR_SPARE_REG23_LSB_ADDR A:0x600a43e0
y.create.l HWIO_QFPROM_CORR_SPARE_REG23_MSB_ADDR A:0x600a43e4
y.create.l HWIO_QFPROM_CORR_SPARE_REG24_LSB_ADDR A:0x600a43e8
y.create.l HWIO_QFPROM_CORR_SPARE_REG24_MSB_ADDR A:0x600a43ec
y.create.l HWIO_QFPROM_CORR_SPARE_REG25_LSB_ADDR A:0x600a43f0
y.create.l HWIO_QFPROM_CORR_SPARE_REG25_MSB_ADDR A:0x600a43f4
y.create.l HWIO_QFPROM_CORR_SPARE_REG26_LSB_ADDR A:0x600a43f8
y.create.l HWIO_QFPROM_CORR_SPARE_REG26_MSB_ADDR A:0x600a43fc
y.create.l HWIO_QFPROM_CORR_ACC_PRIVATE0_ADDR A:0x600a4800
y.create.l HWIO_QFPROM_CORR_ACC_PRIVATE1_ADDR A:0x600a4804
y.create.l HWIO_QFPROM_CORR_ACC_PRIVATE2_ADDR A:0x600a4808
y.create.l HWIO_QFPROM_CORR_ACC_PRIVATE3_ADDR A:0x600a480c
y.create.l HWIO_QFPROM_CORR_ACC_PRIVATE4_ADDR A:0x600a4810
y.create.l HWIO_QFPROM_CORR_ACC_PRIVATE5_ADDR A:0x600a4814
y.create.l HWIO_QFPROM_CORR_ACC_PRIVATE6_ADDR A:0x600a4818
y.create.l HWIO_QFPROM_CORR_ACC_PRIVATE7_ADDR A:0x600a481c
y.create.l HWIO_QFPROM_CORR_ACC_PRIVATE8_ADDR A:0x600a4820
y.create.l HWIO_QFPROM_CORR_ACC_PRIVATE9_ADDR A:0x600a4824
y.create.l HWIO_SEC_CTRL_HW_VERSION_ADDR A:0x600a6000
y.create.l HWIO_FEATURE_CONFIG0_ADDR A:0x600a6004
y.create.l HWIO_FEATURE_CONFIG1_ADDR A:0x600a6008
y.create.l HWIO_FEATURE_CONFIG2_ADDR A:0x600a600c
y.create.l HWIO_FEATURE_CONFIG3_ADDR A:0x600a6010
y.create.l HWIO_FEATURE_CONFIG4_ADDR A:0x600a6014
y.create.l HWIO_FEATURE_CONFIG5_ADDR A:0x600a6018
y.create.l HWIO_OEM_CONFIG0_ADDR A:0x600a601c
y.create.l HWIO_OEM_CONFIG1_ADDR A:0x600a6020
y.create.l HWIO_OEM_CONFIG2_ADDR A:0x600a6024
y.create.l HWIO_OEM_CONFIG3_ADDR A:0x600a6028
y.create.l HWIO_BOOT_CONFIG_ADDR A:0x600a602c
y.create.l HWIO_SECURE_BOOT1_ADDR A:0x600a6034
y.create.l HWIO_SECURE_BOOT2_ADDR A:0x600a6038
y.create.l HWIO_SECURE_BOOT3_ADDR A:0x600a603c
y.create.l HWIO_SECURE_BOOT4_ADDR A:0x600a6040
y.create.l HWIO_SECURE_BOOT5_ADDR A:0x600a6044
y.create.l HWIO_SECURE_BOOT6_ADDR A:0x600a6048
y.create.l HWIO_SECURE_BOOT7_ADDR A:0x600a604c
y.create.l HWIO_OVERRIDE_0_ADDR A:0x600a6058
y.create.l HWIO_OVERRIDE_1_ADDR A:0x600a605c
y.create.l HWIO_OVERRIDE_2_ADDR A:0x600a6060
y.create.l HWIO_OVERRIDE_3_ADDR A:0x600a6064
y.create.l HWIO_OVERRIDE_4_ADDR A:0x600a6068
y.create.l HWIO_CAPT_SEC_GPIO_ADDR A:0x600a606c
y.create.l HWIO_APP_PROC_CFG_ADDR A:0x600a6070
y.create.l HWIO_MSS_PROC_CFG_ADDR A:0x600a6074
y.create.l HWIO_QFPROM_CLK_CTL_ADDR A:0x600a6078
y.create.l HWIO_JTAG_ID_ADDR A:0x600a607c
y.create.l HWIO_OEM_ID_ADDR A:0x600a6080
y.create.l HWIO_TEST_BUS_SEL_ADDR A:0x600a6084
y.create.l HWIO_SPDM_DYN_SECURE_MODE_ADDR A:0x600a6088
y.create.l HWIO_OVERRIDE_5_ADDR A:0x600a608c
y.create.l HWIO_OVERRIDE_6_ADDR A:0x600a6090
y.create.l HWIO_PTE0_ADDR A:0x600a60a0
y.create.l HWIO_PTE1_ADDR A:0x600a60a4
y.create.l HWIO_SERIAL_NUM_ADDR A:0x600a60a8
y.create.l HWIO_PTE2_ADDR A:0x600a60ac
y.create.l HWIO_ANTI_ROLLBACK_1_0_ADDR A:0x600a60b0
y.create.l HWIO_ANTI_ROLLBACK_1_1_ADDR A:0x600a60b4
y.create.l HWIO_ANTI_ROLLBACK_2_0_ADDR A:0x600a60b8
y.create.l HWIO_ANTI_ROLLBACK_2_1_ADDR A:0x600a60bc
y.create.l HWIO_ANTI_ROLLBACK_3_0_ADDR A:0x600a60c0
y.create.l HWIO_ANTI_ROLLBACK_3_1_ADDR A:0x600a60c4
y.create.l HWIO_PK_HASH_0_ADDR A:0x600a60c8
y.create.l HWIO_PK_HASH_1_ADDR A:0x600a60cc
y.create.l HWIO_PK_HASH_2_ADDR A:0x600a60d0
y.create.l HWIO_PK_HASH_3_ADDR A:0x600a60d4
y.create.l HWIO_PK_HASH_4_ADDR A:0x600a60d8
y.create.l HWIO_PK_HASH_5_ADDR A:0x600a60dc
y.create.l HWIO_PK_HASH_6_ADDR A:0x600a60e0
y.create.l HWIO_PK_HASH_7_ADDR A:0x600a60e4
y.create.l HWIO_QFPROM_WRITE_DISABLE_STICKY_BIT0_ADDR A:0x600a6100
y.create.l HWIO_QFPROM_WRITE_DISABLE_STICKY_BIT1_ADDR A:0x600a6104
y.create.l HWIO_KEY_CTRL_VERSION_ADDR A:0x600ab000
y.create.l HWIO_KEY_CTRL_HW_PARAMS_ADDR A:0x600ab004
y.create.l HWIO_KEY_CTRL_STATUS_ADDR A:0x600ab00c
y.create.l HWIO_KEY_CTRL_CACHE0INFO_IDX0_ADDR A:0x600ab010
y.create.l HWIO_KEY_CTRL_CACHE1INFO_IDX0_ADDR A:0x600ab020
y.create.l HWIO_KEY_CTRL_CACHE2INFO_IDX0_ADDR A:0x600ab030
y.create.l HWIO_KEY_CTRL_CACHE3INFO_IDX0_ADDR A:0x600ab040
y.create.l HWIO_KEY_CTRL_CACHE0INFO_IDX1_ADDR A:0x600ab014
y.create.l HWIO_KEY_CTRL_CACHE1INFO_IDX1_ADDR A:0x600ab024
y.create.l HWIO_KEY_CTRL_CACHE2INFO_IDX1_ADDR A:0x600ab034
y.create.l HWIO_KEY_CTRL_CACHE3INFO_IDX1_ADDR A:0x600ab044
y.create.l HWIO_KEY_CTRL_DEBUG_ENABLE_ADDR A:0x600ab100
y.create.l HWIO_KEY_CTRL_DEBUG_BUS_ADDR A:0x600ab104
y.create.l HWIO_KEY_CTRL_CACHE0INFO_IDX2_ADDR A:0x600ab018
y.create.l HWIO_KEY_CTRL_CACHE1INFO_IDX2_ADDR A:0x600ab028
y.create.l HWIO_KEY_CTRL_CACHE2INFO_IDX2_ADDR A:0x600ab038
y.create.l HWIO_KEY_CTRL_CACHE3INFO_IDX2_ADDR A:0x600ab048
y.create.l HWIO_KEY_CTRL_EE0_COMMAND_ADDR A:0x600a8100
y.create.l HWIO_KEY_CTRL_EE1_COMMAND_ADDR A:0x600a9100
y.create.l HWIO_KEY_CTRL_EE2_COMMAND_ADDR A:0x600aa100
y.create.l HWIO_KEY_CTRL_EE0KEY_INFO_ADDR A:0x600a8104
y.create.l HWIO_KEY_CTRL_EE1KEY_INFO_ADDR A:0x600a9104
y.create.l HWIO_KEY_CTRL_EE2KEY_INFO_ADDR A:0x600aa104
y.create.l HWIO_KEY_CTRL_EE0KEY_IDX0_ADDR A:0x600a8200
y.create.l HWIO_KEY_CTRL_EE0KEY_IDX1_ADDR A:0x600a8204
y.create.l HWIO_KEY_CTRL_EE0KEY_IDX2_ADDR A:0x600a8208
y.create.l HWIO_KEY_CTRL_EE0KEY_IDX3_ADDR A:0x600a820c
y.create.l HWIO_KEY_CTRL_EE1KEY_IDX0_ADDR A:0x600a9200
y.create.l HWIO_KEY_CTRL_EE1KEY_IDX1_ADDR A:0x600a9204
y.create.l HWIO_KEY_CTRL_EE1KEY_IDX2_ADDR A:0x600a9208
y.create.l HWIO_KEY_CTRL_EE1KEY_IDX3_ADDR A:0x600a920c
y.create.l HWIO_KEY_CTRL_EE2KEY_IDX0_ADDR A:0x600aa200
y.create.l HWIO_KEY_CTRL_EE2KEY_IDX1_ADDR A:0x600aa204
y.create.l HWIO_KEY_CTRL_EE2KEY_IDX2_ADDR A:0x600aa208
y.create.l HWIO_KEY_CTRL_EE2KEY_IDX3_ADDR A:0x600aa20c
y.create.l HWIO_CRI_CM_CHIP_SERIES_ADDR A:0x600ac000
y.create.l HWIO_CRI_CM_VERSION_ADDR A:0x600ac004
y.create.l HWIO_CRI_CM_DEVICE_ID_0_ADDR A:0x600ac0f0
y.create.l HWIO_CRI_CM_DEVICE_ID_1_ADDR A:0x600ac0f4
y.create.l HWIO_CRI_CM_PADAK_ID_0_ADDR A:0x600ac0f8
y.create.l HWIO_CRI_CM_PADAK_ID_1_ADDR A:0x600ac0fc
y.create.l HWIO_CRI_CM_CONFIG_0_ADDR A:0x600ac0e0
y.create.l HWIO_CRI_CM_CONFIG_1_ADDR A:0x600ac0e4
y.create.l HWIO_CRI_CM_CONFIG_2_ADDR A:0x600ac0e8
y.create.l HWIO_CRI_CM_CONFIG_3_ADDR A:0x600ac0ec
y.create.l HWIO_CRI_CM_STATUS_SUMMARY_ADDR A:0x600ac008
y.create.l HWIO_CRI_CM_STATUS_FLAGS_ADDR A:0x600ac00c
y.create.l HWIO_CRI_CM_STATUS_REGWRITE_COUNT_ADDR A:0x600ac010
y.create.l HWIO_CRI_CM_STATUS_KEYS_ADDR A:0x600ac014
y.create.l HWIO_CRI_CM_STATUS_KEYS_2_ADDR A:0x600ac038
y.create.l HWIO_CRI_CM_ERROR_SEQ_ADDR A:0x600ac034
y.create.l HWIO_CRI_CM_ERROR_INFO_ADDR A:0x600ac018
y.create.l HWIO_CRI_CM_ERROR_OTP_ADDR A:0x600ac01c
y.create.l HWIO_CRI_CM_INIT_ERROR_ADDR_ADDR A:0x600ac060
y.create.l HWIO_CRI_CM_INIT_ERROR_INFO_ADDR A:0x600ac064
y.create.l HWIO_CRI_CM_INIT_ERROR_OTP_ADDR A:0x600ac068
y.create.l HWIO_CRI_CM_OTPCMD_ERROR_ADDR_ADDR A:0x600ac070
y.create.l HWIO_CRI_CM_OTPCMD_ERROR_INFO_ADDR A:0x600ac074
y.create.l HWIO_CRI_CM_OTPCMD_ERROR_OTP_ADDR A:0x600ac078
y.create.l HWIO_CRI_CM_TRNG_ERROR_ADDR A:0x600ac03c
y.create.l HWIO_CRI_CM_TRNG_CTRL_1_ADDR A:0x600ac0d0
y.create.l HWIO_CRI_CM_TRNG_CTRL_2_ADDR A:0x600ac0d4
y.create.l HWIO_CRI_CM_IRQ_CONTROL_ADDR A:0x600ac020
y.create.l HWIO_CRI_CM_IRQ_STATUS_ADDR A:0x600ac024
y.create.l HWIO_CRI_CM_CONTROL_ADDR A:0x600ac028
y.create.l HWIO_CRI_CM_SEQUENCE_INPUT_ADDR A:0x600ac02c
y.create.l HWIO_CRI_CM_SEQUENCE_OUTPUT_ADDR A:0x600ac030
y.create.l HWIO_CRI_CM_SW_BUFFER_0_ADDR A:0x600ac080
y.create.l HWIO_CRI_CM_SW_BUFFER_1_ADDR A:0x600ac084
y.create.l HWIO_CRI_CM_SW_BUFFER_2_ADDR A:0x600ac088
y.create.l HWIO_CRI_CM_SW_BUFFER_3_ADDR A:0x600ac08c
y.create.l HWIO_CRI_CM_SW_BUFFER_4_ADDR A:0x600ac090
y.create.l HWIO_CRI_CM_SW_BUFFER_5_ADDR A:0x600ac094
y.create.l HWIO_CRI_CM_SW_BUFFER_6_ADDR A:0x600ac098
y.create.l HWIO_CRI_CM_SW_BUFFER_7_ADDR A:0x600ac09c
y.create.l HWIO_CRI_CM_SW_BUFFER_8_ADDR A:0x600ac0a0
y.create.l HWIO_CRI_CM_SW_BUFFER_9_ADDR A:0x600ac0a4
y.create.l HWIO_CRI_CM_DIRECTREAD_FEATURE_REQ_ADDR A:0x600ac040
y.create.l HWIO_CRI_CM_DIRECTREAD_FEATURE_STATUS_ADDR A:0x600ac044
y.create.l HWIO_CRI_CM_DIRECTREAD_FEATURE_DATA_ADDR A:0x600ac048
y.create.l HWIO_CRI_CM_DIRECTREAD_OTP_REQ_ADDR A:0x600ac050
y.create.l HWIO_CRI_CM_DIRECTREAD_OTP_STATUS_ADDR A:0x600ac054
y.create.l HWIO_CRI_CM_DIRECTREAD_OTP_DATA_ADDR A:0x600ac058
y.create.l HWIO_CRI_CM_DEVICE_ID_STATUS_ADDR A:0x600ac100
y.create.l HWIO_CRI_CM_CHIP_ID_ADDR A:0x600ac10c
y.create.l HWIO_CRI_CM_CHIP_SERIAL_NUM_ADDR A:0x600ac110
y.create.l HWIO_CRI_CM_OEM_ID_ADDR A:0x600ac114
y.create.l HWIO_CRI_CM_BIST_CTRL_0_ADDR A:0x600ac120
y.create.l HWIO_CRI_CM_TRNG_CTRL_0_ADDR A:0x600ac124
y.create.l HWIO_SEC_CTRL_XPU_XPU_SCR_ADDR A:0x600ae000
y.create.l HWIO_SEC_CTRL_XPU_XPU_SWDR_ADDR A:0x600ae004
y.create.l HWIO_SEC_CTRL_XPU_XPU_SEAR0_ADDR A:0x600ae040
y.create.l HWIO_SEC_CTRL_XPU_XPU_SESR_ADDR A:0x600ae048
y.create.l HWIO_SEC_CTRL_XPU_XPU_SESRRESTORE_ADDR A:0x600ae04c
y.create.l HWIO_SEC_CTRL_XPU_XPU_SESYNR0_ADDR A:0x600ae050
y.create.l HWIO_SEC_CTRL_XPU_XPU_SESYNR1_ADDR A:0x600ae054
y.create.l HWIO_SEC_CTRL_XPU_XPU_SESYNR2_ADDR A:0x600ae058
y.create.l HWIO_SEC_CTRL_XPU_XPU_MCR_ADDR A:0x600ae100
y.create.l HWIO_SEC_CTRL_XPU_XPU_MEAR0_ADDR A:0x600ae140
y.create.l HWIO_SEC_CTRL_XPU_XPU_MESR_ADDR A:0x600ae148
y.create.l HWIO_SEC_CTRL_XPU_XPU_MESRRESTORE_ADDR A:0x600ae14c
y.create.l HWIO_SEC_CTRL_XPU_XPU_MESYNR0_ADDR A:0x600ae150
y.create.l HWIO_SEC_CTRL_XPU_XPU_MESYNR1_ADDR A:0x600ae154
y.create.l HWIO_SEC_CTRL_XPU_XPU_MESYNR2_ADDR A:0x600ae158
y.create.l HWIO_SEC_CTRL_XPU_XPU_CR_ADDR A:0x600ae080
y.create.l HWIO_SEC_CTRL_XPU_XPU_RPU_ACR0_ADDR A:0x600ae0a0
y.create.l HWIO_SEC_CTRL_XPU_XPU_EAR0_ADDR A:0x600ae0c0
y.create.l HWIO_SEC_CTRL_XPU_XPU_ESR_ADDR A:0x600ae0c8
y.create.l HWIO_SEC_CTRL_XPU_XPU_ESRRESTORE_ADDR A:0x600ae0cc
y.create.l HWIO_SEC_CTRL_XPU_XPU_ESYNR0_ADDR A:0x600ae0d0
y.create.l HWIO_SEC_CTRL_XPU_XPU_ESYNR1_ADDR A:0x600ae0d4
y.create.l HWIO_SEC_CTRL_XPU_XPU_ESYNR2_ADDR A:0x600ae0d8
y.create.l HWIO_SEC_CTRL_XPU_XPU_IDR0_ADDR A:0x600ae074
y.create.l HWIO_SEC_CTRL_XPU_XPU_IDR1_ADDR A:0x600ae078
y.create.l HWIO_SEC_CTRL_XPU_XPU_REV_ADDR A:0x600ae07c
y.create.l HWIO_SEC_CTRL_XPU_XPU_RG0_RACR0_ADDR A:0x600ae200
y.create.l HWIO_SEC_CTRL_XPU_XPU_RG1_RACR0_ADDR A:0x600ae280
y.create.l HWIO_SEC_CTRL_XPU_XPU_RG2_RACR0_ADDR A:0x600ae300
y.create.l HWIO_SEC_CTRL_XPU_XPU_RG3_RACR0_ADDR A:0x600ae380
y.create.l HWIO_SEC_CTRL_XPU_XPU_RG4_RACR0_ADDR A:0x600ae400
y.create.l HWIO_SEC_CTRL_XPU_XPU_RG5_RACR0_ADDR A:0x600ae480
y.create.l HWIO_SEC_CTRL_XPU_XPU_RG6_RACR0_ADDR A:0x600ae500
y.create.l HWIO_SEC_CTRL_XPU_XPU_RG7_RACR0_ADDR A:0x600ae580
y.create.l HWIO_SEC_CTRL_XPU_XPU_RG8_RACR0_ADDR A:0x600ae600
y.create.l HWIO_SEC_CTRL_XPU_XPU_RG9_RACR0_ADDR A:0x600ae680
y.create.l HWIO_SEC_CTRL_XPU_XPU_RG0_WACR0_ADDR A:0x600ae220
y.create.l HWIO_SEC_CTRL_XPU_XPU_RG1_WACR0_ADDR A:0x600ae2a0
y.create.l HWIO_SEC_CTRL_XPU_XPU_RG2_WACR0_ADDR A:0x600ae320
y.create.l HWIO_SEC_CTRL_XPU_XPU_RG3_WACR0_ADDR A:0x600ae3a0
y.create.l HWIO_SEC_CTRL_XPU_XPU_RG4_WACR0_ADDR A:0x600ae420
y.create.l HWIO_SEC_CTRL_XPU_XPU_RG5_WACR0_ADDR A:0x600ae4a0
y.create.l HWIO_SEC_CTRL_XPU_XPU_RG6_WACR0_ADDR A:0x600ae520
y.create.l HWIO_SEC_CTRL_XPU_XPU_RG7_WACR0_ADDR A:0x600ae5a0
y.create.l HWIO_SEC_CTRL_XPU_XPU_RG8_WACR0_ADDR A:0x600ae620
y.create.l HWIO_SEC_CTRL_XPU_XPU_RG9_WACR0_ADDR A:0x600ae6a0
y.create.l HWIO_SEC_CTRL_XPU_XPU_RG0_SCR_ADDR A:0x600ae250
y.create.l HWIO_SEC_CTRL_XPU_XPU_RG1_SCR_ADDR A:0x600ae2d0
y.create.l HWIO_SEC_CTRL_XPU_XPU_RG2_SCR_ADDR A:0x600ae350
y.create.l HWIO_SEC_CTRL_XPU_XPU_RG3_SCR_ADDR A:0x600ae3d0
y.create.l HWIO_SEC_CTRL_XPU_XPU_RG4_SCR_ADDR A:0x600ae450
y.create.l HWIO_SEC_CTRL_XPU_XPU_RG5_SCR_ADDR A:0x600ae4d0
y.create.l HWIO_SEC_CTRL_XPU_XPU_RG6_SCR_ADDR A:0x600ae550
y.create.l HWIO_SEC_CTRL_XPU_XPU_RG7_SCR_ADDR A:0x600ae5d0
y.create.l HWIO_SEC_CTRL_XPU_XPU_RG8_SCR_ADDR A:0x600ae650
y.create.l HWIO_SEC_CTRL_XPU_XPU_RG9_SCR_ADDR A:0x600ae6d0
y.create.l HWIO_SEC_CTRL_XPU_XPU_RG0_MCR_ADDR A:0x600ae254
y.create.l HWIO_SEC_CTRL_XPU_XPU_RG1_MCR_ADDR A:0x600ae2d4
y.create.l HWIO_SEC_CTRL_XPU_XPU_RG2_MCR_ADDR A:0x600ae354
y.create.l HWIO_SEC_CTRL_XPU_XPU_RG3_MCR_ADDR A:0x600ae3d4
y.create.l HWIO_SEC_CTRL_XPU_XPU_RG4_MCR_ADDR A:0x600ae454
y.create.l HWIO_SEC_CTRL_XPU_XPU_RG5_MCR_ADDR A:0x600ae4d4
y.create.l HWIO_SEC_CTRL_XPU_XPU_RG6_MCR_ADDR A:0x600ae554
y.create.l HWIO_SEC_CTRL_XPU_XPU_RG7_MCR_ADDR A:0x600ae5d4
y.create.l HWIO_SEC_CTRL_XPU_XPU_RG8_MCR_ADDR A:0x600ae654
y.create.l HWIO_SEC_CTRL_XPU_XPU_RG9_MCR_ADDR A:0x600ae6d4
y.create.l HWIO_TCU_XPU_SCR_TCU_ADDR A:0x60034000
y.create.l HWIO_TCU_XPU_SWDR_TCU_ADDR A:0x60034004
y.create.l HWIO_TCU_XPU_PRTN_RACR_SSHADOW_TCU_ADDR A:0x60034008
y.create.l HWIO_TCU_XPU_PRTN_WACR_SSHADOW_TCU_ADDR A:0x6003400c
y.create.l HWIO_TCU_XPU_PRTN_START_SSHADOW0_TCU_ADDR A:0x60034010
y.create.l HWIO_TCU_XPU_PRTN_END_SSHADOW0_TCU_ADDR A:0x60034018
y.create.l HWIO_TCU_XPU_SEAR0_TCU_ADDR A:0x60034040
y.create.l HWIO_TCU_XPU_SESR_TCU_ADDR A:0x60034048
y.create.l HWIO_TCU_XPU_SESRRESTORE_TCU_ADDR A:0x6003404c
y.create.l HWIO_TCU_XPU_SESYNR0_TCU_ADDR A:0x60034050
y.create.l HWIO_TCU_XPU_SESYNR1_TCU_ADDR A:0x60034054
y.create.l HWIO_TCU_XPU_SESYNR2_TCU_ADDR A:0x60034058
y.create.l HWIO_TCU_XPU_MCR_TCU_ADDR A:0x60034100
y.create.l HWIO_TCU_XPU_MEAR0_TCU_ADDR A:0x60034140
y.create.l HWIO_TCU_XPU_MESR_TCU_ADDR A:0x60034148
y.create.l HWIO_TCU_XPU_MESRRESTORE_TCU_ADDR A:0x6003414c
y.create.l HWIO_TCU_XPU_MESYNR0_TCU_ADDR A:0x60034150
y.create.l HWIO_TCU_XPU_MESYNR1_TCU_ADDR A:0x60034154
y.create.l HWIO_TCU_XPU_MESYNR2_TCU_ADDR A:0x60034158
y.create.l HWIO_TCU_XPU_CR_TCU_ADDR A:0x60034080
y.create.l HWIO_TCU_XPU_PRTN_RACR_SHADOW_TCU_ADDR A:0x60034088
y.create.l HWIO_TCU_XPU_PRTN_WACR_SHADOW_TCU_ADDR A:0x6003408c
y.create.l HWIO_TCU_XPU_PRTN_START_SHADOW0_TCU_ADDR A:0x60034090
y.create.l HWIO_TCU_XPU_PRTN_END_SHADOW0_TCU_ADDR A:0x60034098
y.create.l HWIO_TCU_XPU_RPU_ACR0_TCU_ADDR A:0x600340a0
y.create.l HWIO_TCU_XPU_EAR0_TCU_ADDR A:0x600340c0
y.create.l HWIO_TCU_XPU_ESR_TCU_ADDR A:0x600340c8
y.create.l HWIO_TCU_XPU_ESRRESTORE_TCU_ADDR A:0x600340cc
y.create.l HWIO_TCU_XPU_ESYNR0_TCU_ADDR A:0x600340d0
y.create.l HWIO_TCU_XPU_ESYNR1_TCU_ADDR A:0x600340d4
y.create.l HWIO_TCU_XPU_ESYNR2_TCU_ADDR A:0x600340d8
y.create.l HWIO_TCU_XPU_UMR_RACR_TCU_ADDR A:0x600340e0
y.create.l HWIO_TCU_XPU_UMR_WACR_TCU_ADDR A:0x600340e4
y.create.l HWIO_TCU_XPU_UMR_CNTL_TCU_ADDR A:0x600340f0
y.create.l HWIO_TCU_XPU_IDR0_TCU_ADDR A:0x60034074
y.create.l HWIO_TCU_XPU_IDR1_TCU_ADDR A:0x60034078
y.create.l HWIO_TCU_XPU_REV_TCU_ADDR A:0x6003407c
y.create.l HWIO_TCU_XPU_PRT0_RACR0_TCU_ADDR A:0x60034200
y.create.l HWIO_TCU_XPU_PRT1_RACR0_TCU_ADDR A:0x60034280
y.create.l HWIO_TCU_XPU_PRT2_RACR0_TCU_ADDR A:0x60034300
y.create.l HWIO_TCU_XPU_PRT3_RACR0_TCU_ADDR A:0x60034380
y.create.l HWIO_TCU_XPU_PRT4_RACR0_TCU_ADDR A:0x60034400
y.create.l HWIO_TCU_XPU_PRT5_RACR0_TCU_ADDR A:0x60034480
y.create.l HWIO_TCU_XPU_PRT6_RACR0_TCU_ADDR A:0x60034500
y.create.l HWIO_TCU_XPU_PRT7_RACR0_TCU_ADDR A:0x60034580
y.create.l HWIO_TCU_XPU_PRT8_RACR0_TCU_ADDR A:0x60034600
y.create.l HWIO_TCU_XPU_PRT9_RACR0_TCU_ADDR A:0x60034680
y.create.l HWIO_TCU_XPU_PRT0_WACR0_TCU_ADDR A:0x60034220
y.create.l HWIO_TCU_XPU_PRT1_WACR0_TCU_ADDR A:0x600342a0
y.create.l HWIO_TCU_XPU_PRT2_WACR0_TCU_ADDR A:0x60034320
y.create.l HWIO_TCU_XPU_PRT3_WACR0_TCU_ADDR A:0x600343a0
y.create.l HWIO_TCU_XPU_PRT4_WACR0_TCU_ADDR A:0x60034420
y.create.l HWIO_TCU_XPU_PRT5_WACR0_TCU_ADDR A:0x600344a0
y.create.l HWIO_TCU_XPU_PRT6_WACR0_TCU_ADDR A:0x60034520
y.create.l HWIO_TCU_XPU_PRT7_WACR0_TCU_ADDR A:0x600345a0
y.create.l HWIO_TCU_XPU_PRT8_WACR0_TCU_ADDR A:0x60034620
y.create.l HWIO_TCU_XPU_PRT9_WACR0_TCU_ADDR A:0x600346a0
y.create.l HWIO_TCU_XPU_PRT0_START0_TCU_ADDR A:0x60034240
y.create.l HWIO_TCU_XPU_PRT1_START0_TCU_ADDR A:0x600342c0
y.create.l HWIO_TCU_XPU_PRT2_START0_TCU_ADDR A:0x60034340
y.create.l HWIO_TCU_XPU_PRT3_START0_TCU_ADDR A:0x600343c0
y.create.l HWIO_TCU_XPU_PRT4_START0_TCU_ADDR A:0x60034440
y.create.l HWIO_TCU_XPU_PRT5_START0_TCU_ADDR A:0x600344c0
y.create.l HWIO_TCU_XPU_PRT6_START0_TCU_ADDR A:0x60034540
y.create.l HWIO_TCU_XPU_PRT7_START0_TCU_ADDR A:0x600345c0
y.create.l HWIO_TCU_XPU_PRT8_START0_TCU_ADDR A:0x60034640
y.create.l HWIO_TCU_XPU_PRT9_START0_TCU_ADDR A:0x600346c0
y.create.l HWIO_TCU_XPU_PRT0_END0_TCU_ADDR A:0x60034248
y.create.l HWIO_TCU_XPU_PRT1_END0_TCU_ADDR A:0x600342c8
y.create.l HWIO_TCU_XPU_PRT2_END0_TCU_ADDR A:0x60034348
y.create.l HWIO_TCU_XPU_PRT3_END0_TCU_ADDR A:0x600343c8
y.create.l HWIO_TCU_XPU_PRT4_END0_TCU_ADDR A:0x60034448
y.create.l HWIO_TCU_XPU_PRT5_END0_TCU_ADDR A:0x600344c8
y.create.l HWIO_TCU_XPU_PRT6_END0_TCU_ADDR A:0x60034548
y.create.l HWIO_TCU_XPU_PRT7_END0_TCU_ADDR A:0x600345c8
y.create.l HWIO_TCU_XPU_PRT8_END0_TCU_ADDR A:0x60034648
y.create.l HWIO_TCU_XPU_PRT9_END0_TCU_ADDR A:0x600346c8
y.create.l HWIO_TCU_XPU_PRT0_SCR_TCU_ADDR A:0x60034250
y.create.l HWIO_TCU_XPU_PRT1_SCR_TCU_ADDR A:0x600342d0
y.create.l HWIO_TCU_XPU_PRT2_SCR_TCU_ADDR A:0x60034350
y.create.l HWIO_TCU_XPU_PRT3_SCR_TCU_ADDR A:0x600343d0
y.create.l HWIO_TCU_XPU_PRT4_SCR_TCU_ADDR A:0x60034450
y.create.l HWIO_TCU_XPU_PRT5_SCR_TCU_ADDR A:0x600344d0
y.create.l HWIO_TCU_XPU_PRT6_SCR_TCU_ADDR A:0x60034550
y.create.l HWIO_TCU_XPU_PRT7_SCR_TCU_ADDR A:0x600345d0
y.create.l HWIO_TCU_XPU_PRT8_SCR_TCU_ADDR A:0x60034650
y.create.l HWIO_TCU_XPU_PRT9_SCR_TCU_ADDR A:0x600346d0
y.create.l HWIO_TCU_XPU_PRT0_MCR_TCU_ADDR A:0x60034254
y.create.l HWIO_TCU_XPU_PRT1_MCR_TCU_ADDR A:0x600342d4
y.create.l HWIO_TCU_XPU_PRT2_MCR_TCU_ADDR A:0x60034354
y.create.l HWIO_TCU_XPU_PRT3_MCR_TCU_ADDR A:0x600343d4
y.create.l HWIO_TCU_XPU_PRT4_MCR_TCU_ADDR A:0x60034454
y.create.l HWIO_TCU_XPU_PRT5_MCR_TCU_ADDR A:0x600344d4
y.create.l HWIO_TCU_XPU_PRT6_MCR_TCU_ADDR A:0x60034554
y.create.l HWIO_TCU_XPU_PRT7_MCR_TCU_ADDR A:0x600345d4
y.create.l HWIO_TCU_XPU_PRT8_MCR_TCU_ADDR A:0x60034654
y.create.l HWIO_TCU_XPU_PRT9_MCR_TCU_ADDR A:0x600346d4
y.create.l HWIO_TCU_XPU_PRT0_CNTL0_TCU_ADDR A:0x60034258
y.create.l HWIO_TCU_XPU_PRT1_CNTL0_TCU_ADDR A:0x600342d8
y.create.l HWIO_TCU_XPU_PRT2_CNTL0_TCU_ADDR A:0x60034358
y.create.l HWIO_TCU_XPU_PRT3_CNTL0_TCU_ADDR A:0x600343d8
y.create.l HWIO_TCU_XPU_PRT4_CNTL0_TCU_ADDR A:0x60034458
y.create.l HWIO_TCU_XPU_PRT5_CNTL0_TCU_ADDR A:0x600344d8
y.create.l HWIO_TCU_XPU_PRT6_CNTL0_TCU_ADDR A:0x60034558
y.create.l HWIO_TCU_XPU_PRT7_CNTL0_TCU_ADDR A:0x600345d8
y.create.l HWIO_TCU_XPU_PRT8_CNTL0_TCU_ADDR A:0x60034658
y.create.l HWIO_TCU_XPU_PRT9_CNTL0_TCU_ADDR A:0x600346d8
y.create.l HWIO_TCU_XPU_PRT0_CNTL1_TCU_ADDR A:0x6003425c
y.create.l HWIO_TCU_XPU_PRT1_CNTL1_TCU_ADDR A:0x600342dc
y.create.l HWIO_TCU_XPU_PRT2_CNTL1_TCU_ADDR A:0x6003435c
y.create.l HWIO_TCU_XPU_PRT3_CNTL1_TCU_ADDR A:0x600343dc
y.create.l HWIO_TCU_XPU_PRT4_CNTL1_TCU_ADDR A:0x6003445c
y.create.l HWIO_TCU_XPU_PRT5_CNTL1_TCU_ADDR A:0x600344dc
y.create.l HWIO_TCU_XPU_PRT6_CNTL1_TCU_ADDR A:0x6003455c
y.create.l HWIO_TCU_XPU_PRT7_CNTL1_TCU_ADDR A:0x600345dc
y.create.l HWIO_TCU_XPU_PRT8_CNTL1_TCU_ADDR A:0x6003465c
y.create.l HWIO_TCU_XPU_PRT9_CNTL1_TCU_ADDR A:0x600346dc
y.create.l HWIO_MCDMA_XPU_SCR_MCDMA_ADDR A:0x60035000
y.create.l HWIO_MCDMA_XPU_SWDR_MCDMA_ADDR A:0x60035004
y.create.l HWIO_MCDMA_XPU_PRTN_RACR_SSHADOW_MCDMA_ADDR A:0x60035008
y.create.l HWIO_MCDMA_XPU_PRTN_START_SSHADOW0_MCDMA_ADDR A:0x60035010
y.create.l HWIO_MCDMA_XPU_PRTN_END_SSHADOW0_MCDMA_ADDR A:0x60035018
y.create.l HWIO_MCDMA_XPU_SEAR0_MCDMA_ADDR A:0x60035040
y.create.l HWIO_MCDMA_XPU_SESR_MCDMA_ADDR A:0x60035048
y.create.l HWIO_MCDMA_XPU_SESRRESTORE_MCDMA_ADDR A:0x6003504c
y.create.l HWIO_MCDMA_XPU_SESYNR0_MCDMA_ADDR A:0x60035050
y.create.l HWIO_MCDMA_XPU_SESYNR1_MCDMA_ADDR A:0x60035054
y.create.l HWIO_MCDMA_XPU_SESYNR2_MCDMA_ADDR A:0x60035058
y.create.l HWIO_MCDMA_XPU_MCR_MCDMA_ADDR A:0x60035100
y.create.l HWIO_MCDMA_XPU_MEAR0_MCDMA_ADDR A:0x60035140
y.create.l HWIO_MCDMA_XPU_MESR_MCDMA_ADDR A:0x60035148
y.create.l HWIO_MCDMA_XPU_MESRRESTORE_MCDMA_ADDR A:0x6003514c
y.create.l HWIO_MCDMA_XPU_MESYNR0_MCDMA_ADDR A:0x60035150
y.create.l HWIO_MCDMA_XPU_MESYNR1_MCDMA_ADDR A:0x60035154
y.create.l HWIO_MCDMA_XPU_MESYNR2_MCDMA_ADDR A:0x60035158
y.create.l HWIO_MCDMA_XPU_CR_MCDMA_ADDR A:0x60035080
y.create.l HWIO_MCDMA_XPU_PRTN_RACR_SHADOW_MCDMA_ADDR A:0x60035088
y.create.l HWIO_MCDMA_XPU_PRTN_START_SHADOW0_MCDMA_ADDR A:0x60035090
y.create.l HWIO_MCDMA_XPU_PRTN_END_SHADOW0_MCDMA_ADDR A:0x60035098
y.create.l HWIO_MCDMA_XPU_RPU_ACR0_MCDMA_ADDR A:0x600350a0
y.create.l HWIO_MCDMA_XPU_EAR0_MCDMA_ADDR A:0x600350c0
y.create.l HWIO_MCDMA_XPU_ESR_MCDMA_ADDR A:0x600350c8
y.create.l HWIO_MCDMA_XPU_ESRRESTORE_MCDMA_ADDR A:0x600350cc
y.create.l HWIO_MCDMA_XPU_ESYNR0_MCDMA_ADDR A:0x600350d0
y.create.l HWIO_MCDMA_XPU_ESYNR1_MCDMA_ADDR A:0x600350d4
y.create.l HWIO_MCDMA_XPU_ESYNR2_MCDMA_ADDR A:0x600350d8
y.create.l HWIO_MCDMA_XPU_UMR_RACR_MCDMA_ADDR A:0x600350e0
y.create.l HWIO_MCDMA_XPU_UMR_WACR_MCDMA_ADDR A:0x600350e4
y.create.l HWIO_MCDMA_XPU_UMR_CNTL_MCDMA_ADDR A:0x600350f0
y.create.l HWIO_MCDMA_XPU_IDR0_MCDMA_ADDR A:0x60035074
y.create.l HWIO_MCDMA_XPU_IDR1_MCDMA_ADDR A:0x60035078
y.create.l HWIO_MCDMA_XPU_REV_MCDMA_ADDR A:0x6003507c
y.create.l HWIO_MCDMA_XPU_PRT0_RACR0_MCDMA_ADDR A:0x60035200
y.create.l HWIO_MCDMA_XPU_PRT1_RACR0_MCDMA_ADDR A:0x60035280
y.create.l HWIO_MCDMA_XPU_PRT2_RACR0_MCDMA_ADDR A:0x60035300
y.create.l HWIO_MCDMA_XPU_PRT3_RACR0_MCDMA_ADDR A:0x60035380
y.create.l HWIO_MCDMA_XPU_PRT4_RACR0_MCDMA_ADDR A:0x60035400
y.create.l HWIO_MCDMA_XPU_PRT5_RACR0_MCDMA_ADDR A:0x60035480
y.create.l HWIO_MCDMA_XPU_PRT6_RACR0_MCDMA_ADDR A:0x60035500
y.create.l HWIO_MCDMA_XPU_PRT7_RACR0_MCDMA_ADDR A:0x60035580
y.create.l HWIO_MCDMA_XPU_PRT8_RACR0_MCDMA_ADDR A:0x60035600
y.create.l HWIO_MCDMA_XPU_PRT9_RACR0_MCDMA_ADDR A:0x60035680
y.create.l HWIO_MCDMA_XPU_PRT0_START0_MCDMA_ADDR A:0x60035240
y.create.l HWIO_MCDMA_XPU_PRT1_START0_MCDMA_ADDR A:0x600352c0
y.create.l HWIO_MCDMA_XPU_PRT2_START0_MCDMA_ADDR A:0x60035340
y.create.l HWIO_MCDMA_XPU_PRT3_START0_MCDMA_ADDR A:0x600353c0
y.create.l HWIO_MCDMA_XPU_PRT4_START0_MCDMA_ADDR A:0x60035440
y.create.l HWIO_MCDMA_XPU_PRT5_START0_MCDMA_ADDR A:0x600354c0
y.create.l HWIO_MCDMA_XPU_PRT6_START0_MCDMA_ADDR A:0x60035540
y.create.l HWIO_MCDMA_XPU_PRT7_START0_MCDMA_ADDR A:0x600355c0
y.create.l HWIO_MCDMA_XPU_PRT8_START0_MCDMA_ADDR A:0x60035640
y.create.l HWIO_MCDMA_XPU_PRT9_START0_MCDMA_ADDR A:0x600356c0
y.create.l HWIO_MCDMA_XPU_PRT0_END0_MCDMA_ADDR A:0x60035248
y.create.l HWIO_MCDMA_XPU_PRT1_END0_MCDMA_ADDR A:0x600352c8
y.create.l HWIO_MCDMA_XPU_PRT2_END0_MCDMA_ADDR A:0x60035348
y.create.l HWIO_MCDMA_XPU_PRT3_END0_MCDMA_ADDR A:0x600353c8
y.create.l HWIO_MCDMA_XPU_PRT4_END0_MCDMA_ADDR A:0x60035448
y.create.l HWIO_MCDMA_XPU_PRT5_END0_MCDMA_ADDR A:0x600354c8
y.create.l HWIO_MCDMA_XPU_PRT6_END0_MCDMA_ADDR A:0x60035548
y.create.l HWIO_MCDMA_XPU_PRT7_END0_MCDMA_ADDR A:0x600355c8
y.create.l HWIO_MCDMA_XPU_PRT8_END0_MCDMA_ADDR A:0x60035648
y.create.l HWIO_MCDMA_XPU_PRT9_END0_MCDMA_ADDR A:0x600356c8
y.create.l HWIO_MCDMA_XPU_PRT0_SCR_MCDMA_ADDR A:0x60035250
y.create.l HWIO_MCDMA_XPU_PRT1_SCR_MCDMA_ADDR A:0x600352d0
y.create.l HWIO_MCDMA_XPU_PRT2_SCR_MCDMA_ADDR A:0x60035350
y.create.l HWIO_MCDMA_XPU_PRT3_SCR_MCDMA_ADDR A:0x600353d0
y.create.l HWIO_MCDMA_XPU_PRT4_SCR_MCDMA_ADDR A:0x60035450
y.create.l HWIO_MCDMA_XPU_PRT5_SCR_MCDMA_ADDR A:0x600354d0
y.create.l HWIO_MCDMA_XPU_PRT6_SCR_MCDMA_ADDR A:0x60035550
y.create.l HWIO_MCDMA_XPU_PRT7_SCR_MCDMA_ADDR A:0x600355d0
y.create.l HWIO_MCDMA_XPU_PRT8_SCR_MCDMA_ADDR A:0x60035650
y.create.l HWIO_MCDMA_XPU_PRT9_SCR_MCDMA_ADDR A:0x600356d0
y.create.l HWIO_MCDMA_XPU_PRT0_MCR_MCDMA_ADDR A:0x60035254
y.create.l HWIO_MCDMA_XPU_PRT1_MCR_MCDMA_ADDR A:0x600352d4
y.create.l HWIO_MCDMA_XPU_PRT2_MCR_MCDMA_ADDR A:0x60035354
y.create.l HWIO_MCDMA_XPU_PRT3_MCR_MCDMA_ADDR A:0x600353d4
y.create.l HWIO_MCDMA_XPU_PRT4_MCR_MCDMA_ADDR A:0x60035454
y.create.l HWIO_MCDMA_XPU_PRT5_MCR_MCDMA_ADDR A:0x600354d4
y.create.l HWIO_MCDMA_XPU_PRT6_MCR_MCDMA_ADDR A:0x60035554
y.create.l HWIO_MCDMA_XPU_PRT7_MCR_MCDMA_ADDR A:0x600355d4
y.create.l HWIO_MCDMA_XPU_PRT8_MCR_MCDMA_ADDR A:0x60035654
y.create.l HWIO_MCDMA_XPU_PRT9_MCR_MCDMA_ADDR A:0x600356d4
y.create.l HWIO_MCDMA_XPU_PRT0_CNTL0_MCDMA_ADDR A:0x60035258
y.create.l HWIO_MCDMA_XPU_PRT1_CNTL0_MCDMA_ADDR A:0x600352d8
y.create.l HWIO_MCDMA_XPU_PRT2_CNTL0_MCDMA_ADDR A:0x60035358
y.create.l HWIO_MCDMA_XPU_PRT3_CNTL0_MCDMA_ADDR A:0x600353d8
y.create.l HWIO_MCDMA_XPU_PRT4_CNTL0_MCDMA_ADDR A:0x60035458
y.create.l HWIO_MCDMA_XPU_PRT5_CNTL0_MCDMA_ADDR A:0x600354d8
y.create.l HWIO_MCDMA_XPU_PRT6_CNTL0_MCDMA_ADDR A:0x60035558
y.create.l HWIO_MCDMA_XPU_PRT7_CNTL0_MCDMA_ADDR A:0x600355d8
y.create.l HWIO_MCDMA_XPU_PRT8_CNTL0_MCDMA_ADDR A:0x60035658
y.create.l HWIO_MCDMA_XPU_PRT9_CNTL0_MCDMA_ADDR A:0x600356d8
y.create.l HWIO_MCDMA_XPU_PRT0_CNTL1_MCDMA_ADDR A:0x6003525c
y.create.l HWIO_MCDMA_XPU_PRT1_CNTL1_MCDMA_ADDR A:0x600352dc
y.create.l HWIO_MCDMA_XPU_PRT2_CNTL1_MCDMA_ADDR A:0x6003535c
y.create.l HWIO_MCDMA_XPU_PRT3_CNTL1_MCDMA_ADDR A:0x600353dc
y.create.l HWIO_MCDMA_XPU_PRT4_CNTL1_MCDMA_ADDR A:0x6003545c
y.create.l HWIO_MCDMA_XPU_PRT5_CNTL1_MCDMA_ADDR A:0x600354dc
y.create.l HWIO_MCDMA_XPU_PRT6_CNTL1_MCDMA_ADDR A:0x6003555c
y.create.l HWIO_MCDMA_XPU_PRT7_CNTL1_MCDMA_ADDR A:0x600355dc
y.create.l HWIO_MCDMA_XPU_PRT8_CNTL1_MCDMA_ADDR A:0x6003565c
y.create.l HWIO_MCDMA_XPU_PRT9_CNTL1_MCDMA_ADDR A:0x600356dc
y.create.l HWIO_QDSP_XPU_SCR_QDSP_ADDR A:0x60037000
y.create.l HWIO_QDSP_XPU_SWDR_QDSP_ADDR A:0x60037004
y.create.l HWIO_QDSP_XPU_PRTN_RACR_SSHADOW_QDSP_ADDR A:0x60037008
y.create.l HWIO_QDSP_XPU_PRTN_START_SSHADOW0_QDSP_ADDR A:0x60037010
y.create.l HWIO_QDSP_XPU_PRTN_END_SSHADOW0_QDSP_ADDR A:0x60037018
y.create.l HWIO_QDSP_XPU_SEAR0_QDSP_ADDR A:0x60037040
y.create.l HWIO_QDSP_XPU_SESR_QDSP_ADDR A:0x60037048
y.create.l HWIO_QDSP_XPU_SESRRESTORE_QDSP_ADDR A:0x6003704c
y.create.l HWIO_QDSP_XPU_SESYNR0_QDSP_ADDR A:0x60037050
y.create.l HWIO_QDSP_XPU_SESYNR1_QDSP_ADDR A:0x60037054
y.create.l HWIO_QDSP_XPU_SESYNR2_QDSP_ADDR A:0x60037058
y.create.l HWIO_QDSP_XPU_MCR_QDSP_ADDR A:0x60037100
y.create.l HWIO_QDSP_XPU_MEAR0_QDSP_ADDR A:0x60037140
y.create.l HWIO_QDSP_XPU_MESR_QDSP_ADDR A:0x60037148
y.create.l HWIO_QDSP_XPU_MESRRESTORE_QDSP_ADDR A:0x6003714c
y.create.l HWIO_QDSP_XPU_MESYNR0_QDSP_ADDR A:0x60037150
y.create.l HWIO_QDSP_XPU_MESYNR1_QDSP_ADDR A:0x60037154
y.create.l HWIO_QDSP_XPU_MESYNR2_QDSP_ADDR A:0x60037158
y.create.l HWIO_QDSP_XPU_CR_QDSP_ADDR A:0x60037080
y.create.l HWIO_QDSP_XPU_PRTN_RACR_SHADOW_QDSP_ADDR A:0x60037088
y.create.l HWIO_QDSP_XPU_PRTN_START_SHADOW0_QDSP_ADDR A:0x60037090
y.create.l HWIO_QDSP_XPU_PRTN_END_SHADOW0_QDSP_ADDR A:0x60037098
y.create.l HWIO_QDSP_XPU_RPU_ACR0_QDSP_ADDR A:0x600370a0
y.create.l HWIO_QDSP_XPU_EAR0_QDSP_ADDR A:0x600370c0
y.create.l HWIO_QDSP_XPU_ESR_QDSP_ADDR A:0x600370c8
y.create.l HWIO_QDSP_XPU_ESRRESTORE_QDSP_ADDR A:0x600370cc
y.create.l HWIO_QDSP_XPU_ESYNR0_QDSP_ADDR A:0x600370d0
y.create.l HWIO_QDSP_XPU_ESYNR1_QDSP_ADDR A:0x600370d4
y.create.l HWIO_QDSP_XPU_ESYNR2_QDSP_ADDR A:0x600370d8
y.create.l HWIO_QDSP_XPU_UMR_RACR_QDSP_ADDR A:0x600370e0
y.create.l HWIO_QDSP_XPU_UMR_WACR_QDSP_ADDR A:0x600370e4
y.create.l HWIO_QDSP_XPU_UMR_CNTL_QDSP_ADDR A:0x600370f0
y.create.l HWIO_QDSP_XPU_IDR0_QDSP_ADDR A:0x60037074
y.create.l HWIO_QDSP_XPU_IDR1_QDSP_ADDR A:0x60037078
y.create.l HWIO_QDSP_XPU_REV_QDSP_ADDR A:0x6003707c
y.create.l HWIO_QDSP_XPU_PRT0_RACR0_QDSP_ADDR A:0x60037200
y.create.l HWIO_QDSP_XPU_PRT1_RACR0_QDSP_ADDR A:0x60037280
y.create.l HWIO_QDSP_XPU_PRT2_RACR0_QDSP_ADDR A:0x60037300
y.create.l HWIO_QDSP_XPU_PRT3_RACR0_QDSP_ADDR A:0x60037380
y.create.l HWIO_QDSP_XPU_PRT4_RACR0_QDSP_ADDR A:0x60037400
y.create.l HWIO_QDSP_XPU_PRT5_RACR0_QDSP_ADDR A:0x60037480
y.create.l HWIO_QDSP_XPU_PRT6_RACR0_QDSP_ADDR A:0x60037500
y.create.l HWIO_QDSP_XPU_PRT7_RACR0_QDSP_ADDR A:0x60037580
y.create.l HWIO_QDSP_XPU_PRT8_RACR0_QDSP_ADDR A:0x60037600
y.create.l HWIO_QDSP_XPU_PRT9_RACR0_QDSP_ADDR A:0x60037680
y.create.l HWIO_QDSP_XPU_PRT0_START0_QDSP_ADDR A:0x60037240
y.create.l HWIO_QDSP_XPU_PRT1_START0_QDSP_ADDR A:0x600372c0
y.create.l HWIO_QDSP_XPU_PRT2_START0_QDSP_ADDR A:0x60037340
y.create.l HWIO_QDSP_XPU_PRT3_START0_QDSP_ADDR A:0x600373c0
y.create.l HWIO_QDSP_XPU_PRT4_START0_QDSP_ADDR A:0x60037440
y.create.l HWIO_QDSP_XPU_PRT5_START0_QDSP_ADDR A:0x600374c0
y.create.l HWIO_QDSP_XPU_PRT6_START0_QDSP_ADDR A:0x60037540
y.create.l HWIO_QDSP_XPU_PRT7_START0_QDSP_ADDR A:0x600375c0
y.create.l HWIO_QDSP_XPU_PRT8_START0_QDSP_ADDR A:0x60037640
y.create.l HWIO_QDSP_XPU_PRT9_START0_QDSP_ADDR A:0x600376c0
y.create.l HWIO_QDSP_XPU_PRT0_END0_QDSP_ADDR A:0x60037248
y.create.l HWIO_QDSP_XPU_PRT1_END0_QDSP_ADDR A:0x600372c8
y.create.l HWIO_QDSP_XPU_PRT2_END0_QDSP_ADDR A:0x60037348
y.create.l HWIO_QDSP_XPU_PRT3_END0_QDSP_ADDR A:0x600373c8
y.create.l HWIO_QDSP_XPU_PRT4_END0_QDSP_ADDR A:0x60037448
y.create.l HWIO_QDSP_XPU_PRT5_END0_QDSP_ADDR A:0x600374c8
y.create.l HWIO_QDSP_XPU_PRT6_END0_QDSP_ADDR A:0x60037548
y.create.l HWIO_QDSP_XPU_PRT7_END0_QDSP_ADDR A:0x600375c8
y.create.l HWIO_QDSP_XPU_PRT8_END0_QDSP_ADDR A:0x60037648
y.create.l HWIO_QDSP_XPU_PRT9_END0_QDSP_ADDR A:0x600376c8
y.create.l HWIO_QDSP_XPU_PRT0_SCR_QDSP_ADDR A:0x60037250
y.create.l HWIO_QDSP_XPU_PRT1_SCR_QDSP_ADDR A:0x600372d0
y.create.l HWIO_QDSP_XPU_PRT2_SCR_QDSP_ADDR A:0x60037350
y.create.l HWIO_QDSP_XPU_PRT3_SCR_QDSP_ADDR A:0x600373d0
y.create.l HWIO_QDSP_XPU_PRT4_SCR_QDSP_ADDR A:0x60037450
y.create.l HWIO_QDSP_XPU_PRT5_SCR_QDSP_ADDR A:0x600374d0
y.create.l HWIO_QDSP_XPU_PRT6_SCR_QDSP_ADDR A:0x60037550
y.create.l HWIO_QDSP_XPU_PRT7_SCR_QDSP_ADDR A:0x600375d0
y.create.l HWIO_QDSP_XPU_PRT8_SCR_QDSP_ADDR A:0x60037650
y.create.l HWIO_QDSP_XPU_PRT9_SCR_QDSP_ADDR A:0x600376d0
y.create.l HWIO_QDSP_XPU_PRT0_MCR_QDSP_ADDR A:0x60037254
y.create.l HWIO_QDSP_XPU_PRT1_MCR_QDSP_ADDR A:0x600372d4
y.create.l HWIO_QDSP_XPU_PRT2_MCR_QDSP_ADDR A:0x60037354
y.create.l HWIO_QDSP_XPU_PRT3_MCR_QDSP_ADDR A:0x600373d4
y.create.l HWIO_QDSP_XPU_PRT4_MCR_QDSP_ADDR A:0x60037454
y.create.l HWIO_QDSP_XPU_PRT5_MCR_QDSP_ADDR A:0x600374d4
y.create.l HWIO_QDSP_XPU_PRT6_MCR_QDSP_ADDR A:0x60037554
y.create.l HWIO_QDSP_XPU_PRT7_MCR_QDSP_ADDR A:0x600375d4
y.create.l HWIO_QDSP_XPU_PRT8_MCR_QDSP_ADDR A:0x60037654
y.create.l HWIO_QDSP_XPU_PRT9_MCR_QDSP_ADDR A:0x600376d4
y.create.l HWIO_QDSP_XPU_PRT0_CNTL0_QDSP_ADDR A:0x60037258
y.create.l HWIO_QDSP_XPU_PRT1_CNTL0_QDSP_ADDR A:0x600372d8
y.create.l HWIO_QDSP_XPU_PRT2_CNTL0_QDSP_ADDR A:0x60037358
y.create.l HWIO_QDSP_XPU_PRT3_CNTL0_QDSP_ADDR A:0x600373d8
y.create.l HWIO_QDSP_XPU_PRT4_CNTL0_QDSP_ADDR A:0x60037458
y.create.l HWIO_QDSP_XPU_PRT5_CNTL0_QDSP_ADDR A:0x600374d8
y.create.l HWIO_QDSP_XPU_PRT6_CNTL0_QDSP_ADDR A:0x60037558
y.create.l HWIO_QDSP_XPU_PRT7_CNTL0_QDSP_ADDR A:0x600375d8
y.create.l HWIO_QDSP_XPU_PRT8_CNTL0_QDSP_ADDR A:0x60037658
y.create.l HWIO_QDSP_XPU_PRT9_CNTL0_QDSP_ADDR A:0x600376d8
y.create.l HWIO_QDSP_XPU_PRT0_CNTL1_QDSP_ADDR A:0x6003725c
y.create.l HWIO_QDSP_XPU_PRT1_CNTL1_QDSP_ADDR A:0x600372dc
y.create.l HWIO_QDSP_XPU_PRT2_CNTL1_QDSP_ADDR A:0x6003735c
y.create.l HWIO_QDSP_XPU_PRT3_CNTL1_QDSP_ADDR A:0x600373dc
y.create.l HWIO_QDSP_XPU_PRT4_CNTL1_QDSP_ADDR A:0x6003745c
y.create.l HWIO_QDSP_XPU_PRT5_CNTL1_QDSP_ADDR A:0x600374dc
y.create.l HWIO_QDSP_XPU_PRT6_CNTL1_QDSP_ADDR A:0x6003755c
y.create.l HWIO_QDSP_XPU_PRT7_CNTL1_QDSP_ADDR A:0x600375dc
y.create.l HWIO_QDSP_XPU_PRT8_CNTL1_QDSP_ADDR A:0x6003765c
y.create.l HWIO_QDSP_XPU_PRT9_CNTL1_QDSP_ADDR A:0x600376dc
y.create.l HWIO_GPS_XPU_SCR_GPS_ADDR A:0x60036000
y.create.l HWIO_GPS_XPU_SWDR_GPS_ADDR A:0x60036004
y.create.l HWIO_GPS_XPU_PRTN_RACR_SSHADOW_GPS_ADDR A:0x60036008
y.create.l HWIO_GPS_XPU_PRTN_START_SSHADOW0_GPS_ADDR A:0x60036010
y.create.l HWIO_GPS_XPU_PRTN_END_SSHADOW0_GPS_ADDR A:0x60036018
y.create.l HWIO_GPS_XPU_SEAR0_GPS_ADDR A:0x60036040
y.create.l HWIO_GPS_XPU_SESR_GPS_ADDR A:0x60036048
y.create.l HWIO_GPS_XPU_SESRRESTORE_GPS_ADDR A:0x6003604c
y.create.l HWIO_GPS_XPU_SESYNR0_GPS_ADDR A:0x60036050
y.create.l HWIO_GPS_XPU_SESYNR1_GPS_ADDR A:0x60036054
y.create.l HWIO_GPS_XPU_SESYNR2_GPS_ADDR A:0x60036058
y.create.l HWIO_GPS_XPU_MCR_GPS_ADDR A:0x60036100
y.create.l HWIO_GPS_XPU_MEAR0_GPS_ADDR A:0x60036140
y.create.l HWIO_GPS_XPU_MESR_GPS_ADDR A:0x60036148
y.create.l HWIO_GPS_XPU_MESRRESTORE_GPS_ADDR A:0x6003614c
y.create.l HWIO_GPS_XPU_MESYNR0_GPS_ADDR A:0x60036150
y.create.l HWIO_GPS_XPU_MESYNR1_GPS_ADDR A:0x60036154
y.create.l HWIO_GPS_XPU_MESYNR2_GPS_ADDR A:0x60036158
y.create.l HWIO_GPS_XPU_CR_GPS_ADDR A:0x60036080
y.create.l HWIO_GPS_XPU_PRTN_RACR_SHADOW_GPS_ADDR A:0x60036088
y.create.l HWIO_GPS_XPU_PRTN_START_SHADOW0_GPS_ADDR A:0x60036090
y.create.l HWIO_GPS_XPU_PRTN_END_SHADOW0_GPS_ADDR A:0x60036098
y.create.l HWIO_GPS_XPU_RPU_ACR0_GPS_ADDR A:0x600360a0
y.create.l HWIO_GPS_XPU_EAR0_GPS_ADDR A:0x600360c0
y.create.l HWIO_GPS_XPU_ESR_GPS_ADDR A:0x600360c8
y.create.l HWIO_GPS_XPU_ESRRESTORE_GPS_ADDR A:0x600360cc
y.create.l HWIO_GPS_XPU_ESYNR0_GPS_ADDR A:0x600360d0
y.create.l HWIO_GPS_XPU_ESYNR1_GPS_ADDR A:0x600360d4
y.create.l HWIO_GPS_XPU_ESYNR2_GPS_ADDR A:0x600360d8
y.create.l HWIO_GPS_XPU_UMR_RACR_GPS_ADDR A:0x600360e0
y.create.l HWIO_GPS_XPU_UMR_WACR_GPS_ADDR A:0x600360e4
y.create.l HWIO_GPS_XPU_UMR_CNTL_GPS_ADDR A:0x600360f0
y.create.l HWIO_GPS_XPU_IDR0_GPS_ADDR A:0x60036074
y.create.l HWIO_GPS_XPU_IDR1_GPS_ADDR A:0x60036078
y.create.l HWIO_GPS_XPU_REV_GPS_ADDR A:0x6003607c
y.create.l HWIO_GPS_XPU_PRT0_RACR0_GPS_ADDR A:0x60036200
y.create.l HWIO_GPS_XPU_PRT1_RACR0_GPS_ADDR A:0x60036280
y.create.l HWIO_GPS_XPU_PRT2_RACR0_GPS_ADDR A:0x60036300
y.create.l HWIO_GPS_XPU_PRT3_RACR0_GPS_ADDR A:0x60036380
y.create.l HWIO_GPS_XPU_PRT4_RACR0_GPS_ADDR A:0x60036400
y.create.l HWIO_GPS_XPU_PRT5_RACR0_GPS_ADDR A:0x60036480
y.create.l HWIO_GPS_XPU_PRT6_RACR0_GPS_ADDR A:0x60036500
y.create.l HWIO_GPS_XPU_PRT7_RACR0_GPS_ADDR A:0x60036580
y.create.l HWIO_GPS_XPU_PRT8_RACR0_GPS_ADDR A:0x60036600
y.create.l HWIO_GPS_XPU_PRT9_RACR0_GPS_ADDR A:0x60036680
y.create.l HWIO_GPS_XPU_PRT0_START0_GPS_ADDR A:0x60036240
y.create.l HWIO_GPS_XPU_PRT1_START0_GPS_ADDR A:0x600362c0
y.create.l HWIO_GPS_XPU_PRT2_START0_GPS_ADDR A:0x60036340
y.create.l HWIO_GPS_XPU_PRT3_START0_GPS_ADDR A:0x600363c0
y.create.l HWIO_GPS_XPU_PRT4_START0_GPS_ADDR A:0x60036440
y.create.l HWIO_GPS_XPU_PRT5_START0_GPS_ADDR A:0x600364c0
y.create.l HWIO_GPS_XPU_PRT6_START0_GPS_ADDR A:0x60036540
y.create.l HWIO_GPS_XPU_PRT7_START0_GPS_ADDR A:0x600365c0
y.create.l HWIO_GPS_XPU_PRT8_START0_GPS_ADDR A:0x60036640
y.create.l HWIO_GPS_XPU_PRT9_START0_GPS_ADDR A:0x600366c0
y.create.l HWIO_GPS_XPU_PRT0_END0_GPS_ADDR A:0x60036248
y.create.l HWIO_GPS_XPU_PRT1_END0_GPS_ADDR A:0x600362c8
y.create.l HWIO_GPS_XPU_PRT2_END0_GPS_ADDR A:0x60036348
y.create.l HWIO_GPS_XPU_PRT3_END0_GPS_ADDR A:0x600363c8
y.create.l HWIO_GPS_XPU_PRT4_END0_GPS_ADDR A:0x60036448
y.create.l HWIO_GPS_XPU_PRT5_END0_GPS_ADDR A:0x600364c8
y.create.l HWIO_GPS_XPU_PRT6_END0_GPS_ADDR A:0x60036548
y.create.l HWIO_GPS_XPU_PRT7_END0_GPS_ADDR A:0x600365c8
y.create.l HWIO_GPS_XPU_PRT8_END0_GPS_ADDR A:0x60036648
y.create.l HWIO_GPS_XPU_PRT9_END0_GPS_ADDR A:0x600366c8
y.create.l HWIO_GPS_XPU_PRT0_SCR_GPS_ADDR A:0x60036250
y.create.l HWIO_GPS_XPU_PRT1_SCR_GPS_ADDR A:0x600362d0
y.create.l HWIO_GPS_XPU_PRT2_SCR_GPS_ADDR A:0x60036350
y.create.l HWIO_GPS_XPU_PRT3_SCR_GPS_ADDR A:0x600363d0
y.create.l HWIO_GPS_XPU_PRT4_SCR_GPS_ADDR A:0x60036450
y.create.l HWIO_GPS_XPU_PRT5_SCR_GPS_ADDR A:0x600364d0
y.create.l HWIO_GPS_XPU_PRT6_SCR_GPS_ADDR A:0x60036550
y.create.l HWIO_GPS_XPU_PRT7_SCR_GPS_ADDR A:0x600365d0
y.create.l HWIO_GPS_XPU_PRT8_SCR_GPS_ADDR A:0x60036650
y.create.l HWIO_GPS_XPU_PRT9_SCR_GPS_ADDR A:0x600366d0
y.create.l HWIO_GPS_XPU_PRT0_MCR_GPS_ADDR A:0x60036254
y.create.l HWIO_GPS_XPU_PRT1_MCR_GPS_ADDR A:0x600362d4
y.create.l HWIO_GPS_XPU_PRT2_MCR_GPS_ADDR A:0x60036354
y.create.l HWIO_GPS_XPU_PRT3_MCR_GPS_ADDR A:0x600363d4
y.create.l HWIO_GPS_XPU_PRT4_MCR_GPS_ADDR A:0x60036454
y.create.l HWIO_GPS_XPU_PRT5_MCR_GPS_ADDR A:0x600364d4
y.create.l HWIO_GPS_XPU_PRT6_MCR_GPS_ADDR A:0x60036554
y.create.l HWIO_GPS_XPU_PRT7_MCR_GPS_ADDR A:0x600365d4
y.create.l HWIO_GPS_XPU_PRT8_MCR_GPS_ADDR A:0x60036654
y.create.l HWIO_GPS_XPU_PRT9_MCR_GPS_ADDR A:0x600366d4
y.create.l HWIO_GPS_XPU_PRT0_CNTL0_GPS_ADDR A:0x60036258
y.create.l HWIO_GPS_XPU_PRT1_CNTL0_GPS_ADDR A:0x600362d8
y.create.l HWIO_GPS_XPU_PRT2_CNTL0_GPS_ADDR A:0x60036358
y.create.l HWIO_GPS_XPU_PRT3_CNTL0_GPS_ADDR A:0x600363d8
y.create.l HWIO_GPS_XPU_PRT4_CNTL0_GPS_ADDR A:0x60036458
y.create.l HWIO_GPS_XPU_PRT5_CNTL0_GPS_ADDR A:0x600364d8
y.create.l HWIO_GPS_XPU_PRT6_CNTL0_GPS_ADDR A:0x60036558
y.create.l HWIO_GPS_XPU_PRT7_CNTL0_GPS_ADDR A:0x600365d8
y.create.l HWIO_GPS_XPU_PRT8_CNTL0_GPS_ADDR A:0x60036658
y.create.l HWIO_GPS_XPU_PRT9_CNTL0_GPS_ADDR A:0x600366d8
y.create.l HWIO_GPS_XPU_PRT0_CNTL1_GPS_ADDR A:0x6003625c
y.create.l HWIO_GPS_XPU_PRT1_CNTL1_GPS_ADDR A:0x600362dc
y.create.l HWIO_GPS_XPU_PRT2_CNTL1_GPS_ADDR A:0x6003635c
y.create.l HWIO_GPS_XPU_PRT3_CNTL1_GPS_ADDR A:0x600363dc
y.create.l HWIO_GPS_XPU_PRT4_CNTL1_GPS_ADDR A:0x6003645c
y.create.l HWIO_GPS_XPU_PRT5_CNTL1_GPS_ADDR A:0x600364dc
y.create.l HWIO_GPS_XPU_PRT6_CNTL1_GPS_ADDR A:0x6003655c
y.create.l HWIO_GPS_XPU_PRT7_CNTL1_GPS_ADDR A:0x600365dc
y.create.l HWIO_GPS_XPU_PRT8_CNTL1_GPS_ADDR A:0x6003665c
y.create.l HWIO_GPS_XPU_PRT9_CNTL1_GPS_ADDR A:0x600366dc
y.create.l HWIO_APPS_SMMU_SCR0_APPS_ADDR A:0x61e00000
y.create.l HWIO_APPS_SMMU_NSCR0_APPS_ADDR A:0x61e00400
y.create.l HWIO_APPS_SMMU_SCR1_APPS_ADDR A:0x61e00004
y.create.l HWIO_APPS_SMMU_SACR_APPS_ADDR A:0x61e00010
y.create.l HWIO_APPS_SMMU_NSACR_APPS_ADDR A:0x61e00410
y.create.l HWIO_APPS_SMMU_SIDR0_APPS_ADDR A:0x61e00020
y.create.l HWIO_APPS_SMMU_SIDR1_APPS_ADDR A:0x61e00024
y.create.l HWIO_APPS_SMMU_SIDR2_APPS_ADDR A:0x61e00028
y.create.l HWIO_APPS_SMMU_SIDR7_APPS_ADDR A:0x61e0003c
y.create.l HWIO_APPS_SMMU_SGFAR_LOW_APPS_ADDR A:0x61e00040
y.create.l HWIO_APPS_SMMU_SGFAR_HIGH_APPS_ADDR A:0x61e00044
y.create.l HWIO_APPS_SMMU_NSGFAR_LOW_APPS_ADDR A:0x61e00440
y.create.l HWIO_APPS_SMMU_NSGFAR_HIGH_APPS_ADDR A:0x61e00444
y.create.l HWIO_APPS_SMMU_SGFSR_APPS_ADDR A:0x61e00048
y.create.l HWIO_APPS_SMMU_NSGFSR_APPS_ADDR A:0x61e00448
y.create.l HWIO_APPS_SMMU_SGFSRRESTORE_APPS_ADDR A:0x61e0004c
y.create.l HWIO_APPS_SMMU_NSGFSRRESTORE_APPS_ADDR A:0x61e0044c
y.create.l HWIO_APPS_SMMU_SGFSYNR0_APPS_ADDR A:0x61e00050
y.create.l HWIO_APPS_SMMU_NSGFSYNR0_APPS_ADDR A:0x61e00450
y.create.l HWIO_APPS_SMMU_SGFSYNR1_APPS_ADDR A:0x61e00054
y.create.l HWIO_APPS_SMMU_NSGFSYNDR1_APPS_ADDR A:0x61e00454
y.create.l HWIO_APPS_SMMU_STLBIALL_APPS_ADDR A:0x61e00060
y.create.l HWIO_APPS_SMMU_TLBIVMID_APPS_ADDR A:0x61e00064
y.create.l HWIO_APPS_SMMU_TLBIALLNSNH_APPS_ADDR A:0x61e00068
y.create.l HWIO_APPS_SMMU_NSTLBGSYNC_APPS_ADDR A:0x61e00470
y.create.l HWIO_APPS_SMMU_STLBGSYNC_APPS_ADDR A:0x61e00070
y.create.l HWIO_APPS_SMMU_STLBGSTATUS_APPS_ADDR A:0x61e00074
y.create.l HWIO_APPS_SMMU_NSTLBGSTATUS_APPS_ADDR A:0x61e00474
y.create.l HWIO_APPS_SMMU_DBGRPTRTBU_APPS_ADDR A:0x61e00080
y.create.l HWIO_APPS_SMMU_DBGRDATATBU_APPS_ADDR A:0x61e00084
y.create.l HWIO_APPS_SMMU_DBGRPTRTCU_APPS_ADDR A:0x61e00088
y.create.l HWIO_APPS_SMMU_DBGRDATATCU_APPS_ADDR A:0x61e0008c
y.create.l HWIO_APPS_SMMU_STLBIVALM_LOW_APPS_ADDR A:0x61e000a0
y.create.l HWIO_APPS_SMMU_STLBIVALM_HIGH_APPS_ADDR A:0x61e000a4
y.create.l HWIO_APPS_SMMU_STLBIVAM_LOW_APPS_ADDR A:0x61e000a8
y.create.l HWIO_APPS_SMMU_STLBIVAM_HIGH_APPS_ADDR A:0x61e000ac
y.create.l HWIO_APPS_SMMU_STLBIALLM_APPS_ADDR A:0x61e000bc
y.create.l HWIO_APPS_SMMU_SMR0_APPS_ADDR A:0x61e00800
y.create.l HWIO_APPS_SMMU_SMR1_APPS_ADDR A:0x61e00804
y.create.l HWIO_APPS_SMMU_SMR2_APPS_ADDR A:0x61e00808
y.create.l HWIO_APPS_SMMU_SMR3_APPS_ADDR A:0x61e0080c
y.create.l HWIO_APPS_SMMU_SMR4_APPS_ADDR A:0x61e00810
y.create.l HWIO_APPS_SMMU_SMR5_APPS_ADDR A:0x61e00814
y.create.l HWIO_APPS_SMMU_SMR6_APPS_ADDR A:0x61e00818
y.create.l HWIO_APPS_SMMU_SMR7_APPS_ADDR A:0x61e0081c
y.create.l HWIO_APPS_SMMU_SMR8_APPS_ADDR A:0x61e00820
y.create.l HWIO_APPS_SMMU_SMR9_APPS_ADDR A:0x61e00824
y.create.l HWIO_APPS_SMMU_SMR10_APPS_ADDR A:0x61e00828
y.create.l HWIO_APPS_SMMU_SMR11_APPS_ADDR A:0x61e0082c
y.create.l HWIO_APPS_SMMU_SMR12_APPS_ADDR A:0x61e00830
y.create.l HWIO_APPS_SMMU_SMR13_APPS_ADDR A:0x61e00834
y.create.l HWIO_APPS_SMMU_SMR14_APPS_ADDR A:0x61e00838
y.create.l HWIO_APPS_SMMU_SMR15_APPS_ADDR A:0x61e0083c
y.create.l HWIO_APPS_SMMU_SMR16_APPS_ADDR A:0x61e00840
y.create.l HWIO_APPS_SMMU_SMR17_APPS_ADDR A:0x61e00844
y.create.l HWIO_APPS_SMMU_SMR18_APPS_ADDR A:0x61e00848
y.create.l HWIO_APPS_SMMU_SMR19_APPS_ADDR A:0x61e0084c
y.create.l HWIO_APPS_SMMU_SMR20_APPS_ADDR A:0x61e00850
y.create.l HWIO_APPS_SMMU_SMR21_APPS_ADDR A:0x61e00854
y.create.l HWIO_APPS_SMMU_SMR22_APPS_ADDR A:0x61e00858
y.create.l HWIO_APPS_SMMU_SMR23_APPS_ADDR A:0x61e0085c
y.create.l HWIO_APPS_SMMU_SMR24_APPS_ADDR A:0x61e00860
y.create.l HWIO_APPS_SMMU_SMR25_APPS_ADDR A:0x61e00864
y.create.l HWIO_APPS_SMMU_SMR26_APPS_ADDR A:0x61e00868
y.create.l HWIO_APPS_SMMU_SMR27_APPS_ADDR A:0x61e0086c
y.create.l HWIO_APPS_SMMU_SMR28_APPS_ADDR A:0x61e00870
y.create.l HWIO_APPS_SMMU_SMR29_APPS_ADDR A:0x61e00874
y.create.l HWIO_APPS_SMMU_SMR30_APPS_ADDR A:0x61e00878
y.create.l HWIO_APPS_SMMU_SMR31_APPS_ADDR A:0x61e0087c
y.create.l HWIO_APPS_SMMU_S2CR0_APPS_ADDR A:0x61e00c00
y.create.l HWIO_APPS_SMMU_S2CR1_APPS_ADDR A:0x61e00c04
y.create.l HWIO_APPS_SMMU_S2CR2_APPS_ADDR A:0x61e00c08
y.create.l HWIO_APPS_SMMU_S2CR3_APPS_ADDR A:0x61e00c0c
y.create.l HWIO_APPS_SMMU_S2CR4_APPS_ADDR A:0x61e00c10
y.create.l HWIO_APPS_SMMU_S2CR5_APPS_ADDR A:0x61e00c14
y.create.l HWIO_APPS_SMMU_S2CR6_APPS_ADDR A:0x61e00c18
y.create.l HWIO_APPS_SMMU_S2CR7_APPS_ADDR A:0x61e00c1c
y.create.l HWIO_APPS_SMMU_S2CR8_APPS_ADDR A:0x61e00c20
y.create.l HWIO_APPS_SMMU_S2CR9_APPS_ADDR A:0x61e00c24
y.create.l HWIO_APPS_SMMU_S2CR10_APPS_ADDR A:0x61e00c28
y.create.l HWIO_APPS_SMMU_S2CR11_APPS_ADDR A:0x61e00c2c
y.create.l HWIO_APPS_SMMU_S2CR12_APPS_ADDR A:0x61e00c30
y.create.l HWIO_APPS_SMMU_S2CR13_APPS_ADDR A:0x61e00c34
y.create.l HWIO_APPS_SMMU_S2CR14_APPS_ADDR A:0x61e00c38
y.create.l HWIO_APPS_SMMU_S2CR15_APPS_ADDR A:0x61e00c3c
y.create.l HWIO_APPS_SMMU_S2CR16_APPS_ADDR A:0x61e00c40
y.create.l HWIO_APPS_SMMU_S2CR17_APPS_ADDR A:0x61e00c44
y.create.l HWIO_APPS_SMMU_S2CR18_APPS_ADDR A:0x61e00c48
y.create.l HWIO_APPS_SMMU_S2CR19_APPS_ADDR A:0x61e00c4c
y.create.l HWIO_APPS_SMMU_S2CR20_APPS_ADDR A:0x61e00c50
y.create.l HWIO_APPS_SMMU_S2CR21_APPS_ADDR A:0x61e00c54
y.create.l HWIO_APPS_SMMU_S2CR22_APPS_ADDR A:0x61e00c58
y.create.l HWIO_APPS_SMMU_S2CR23_APPS_ADDR A:0x61e00c5c
y.create.l HWIO_APPS_SMMU_S2CR24_APPS_ADDR A:0x61e00c60
y.create.l HWIO_APPS_SMMU_S2CR25_APPS_ADDR A:0x61e00c64
y.create.l HWIO_APPS_SMMU_S2CR26_APPS_ADDR A:0x61e00c68
y.create.l HWIO_APPS_SMMU_S2CR27_APPS_ADDR A:0x61e00c6c
y.create.l HWIO_APPS_SMMU_S2CR28_APPS_ADDR A:0x61e00c70
y.create.l HWIO_APPS_SMMU_S2CR29_APPS_ADDR A:0x61e00c74
y.create.l HWIO_APPS_SMMU_S2CR30_APPS_ADDR A:0x61e00c78
y.create.l HWIO_APPS_SMMU_S2CR31_APPS_ADDR A:0x61e00c7c
y.create.l HWIO_APPS_SMMU_PIDR0_APPS_ADDR A:0x61e00fe0
y.create.l HWIO_APPS_SMMU_PIDR1_APPS_ADDR A:0x61e00fe4
y.create.l HWIO_APPS_SMMU_PIDR2_APPS_ADDR A:0x61e00fe8
y.create.l HWIO_APPS_SMMU_PIDR3_APPS_ADDR A:0x61e00fec
y.create.l HWIO_APPS_SMMU_PIDR4_APPS_ADDR A:0x61e00fd0
y.create.l HWIO_APPS_SMMU_PIDR5_APPS_ADDR A:0x61e00fd4
y.create.l HWIO_APPS_SMMU_PIDR6_APPS_ADDR A:0x61e00fd8
y.create.l HWIO_APPS_SMMU_PIDR7_APPS_ADDR A:0x61e00fdc
y.create.l HWIO_APPS_SMMU_CIDR0_APPS_ADDR A:0x61e00ff0
y.create.l HWIO_APPS_SMMU_CIDR1_APPS_ADDR A:0x61e00ff4
y.create.l HWIO_APPS_SMMU_CIDR2_APPS_ADDR A:0x61e00ff8
y.create.l HWIO_APPS_SMMU_CIDR3_APPS_ADDR A:0x61e00ffc
y.create.l HWIO_APPS_SMMU_CBAR0_APPS_ADDR A:0x61e01000
y.create.l HWIO_APPS_SMMU_CBFRSYNRA0_APPS_ADDR A:0x61e01400
y.create.l HWIO_APPS_SMMU_CBA2R0_APPS_ADDR A:0x61e01800
y.create.l HWIO_APPS_SMMU_CBAR1_APPS_ADDR A:0x61e01004
y.create.l HWIO_APPS_SMMU_CBFRSYNRA1_APPS_ADDR A:0x61e01404
y.create.l HWIO_APPS_SMMU_CBA2R1_APPS_ADDR A:0x61e01804
y.create.l HWIO_APPS_SMMU_CBAR2_APPS_ADDR A:0x61e01008
y.create.l HWIO_APPS_SMMU_CBFRSYNRA2_APPS_ADDR A:0x61e01408
y.create.l HWIO_APPS_SMMU_CBA2R2_APPS_ADDR A:0x61e01808
y.create.l HWIO_APPS_SMMU_CBAR3_APPS_ADDR A:0x61e0100c
y.create.l HWIO_APPS_SMMU_CBFRSYNRA3_APPS_ADDR A:0x61e0140c
y.create.l HWIO_APPS_SMMU_CBA2R3_APPS_ADDR A:0x61e0180c
y.create.l HWIO_APPS_SMMU_CBAR4_APPS_ADDR A:0x61e01010
y.create.l HWIO_APPS_SMMU_CBFRSYNRA4_APPS_ADDR A:0x61e01410
y.create.l HWIO_APPS_SMMU_CBA2R4_APPS_ADDR A:0x61e01810
y.create.l HWIO_APPS_SMMU_CBAR5_APPS_ADDR A:0x61e01014
y.create.l HWIO_APPS_SMMU_CBFRSYNRA5_APPS_ADDR A:0x61e01414
y.create.l HWIO_APPS_SMMU_CBA2R5_APPS_ADDR A:0x61e01814
y.create.l HWIO_APPS_SMMU_CBAR6_APPS_ADDR A:0x61e01018
y.create.l HWIO_APPS_SMMU_CBFRSYNRA6_APPS_ADDR A:0x61e01418
y.create.l HWIO_APPS_SMMU_CBA2R6_APPS_ADDR A:0x61e01818
y.create.l HWIO_APPS_SMMU_CBAR7_APPS_ADDR A:0x61e0101c
y.create.l HWIO_APPS_SMMU_CBFRSYNRA7_APPS_ADDR A:0x61e0141c
y.create.l HWIO_APPS_SMMU_CBA2R7_APPS_ADDR A:0x61e0181c
y.create.l HWIO_APPS_SMMU_CBAR8_APPS_ADDR A:0x61e01020
y.create.l HWIO_APPS_SMMU_CBFRSYNRA8_APPS_ADDR A:0x61e01420
y.create.l HWIO_APPS_SMMU_CBA2R8_APPS_ADDR A:0x61e01820
y.create.l HWIO_APPS_SMMU_CBAR9_APPS_ADDR A:0x61e01024
y.create.l HWIO_APPS_SMMU_CBFRSYNRA9_APPS_ADDR A:0x61e01424
y.create.l HWIO_APPS_SMMU_CBA2R9_APPS_ADDR A:0x61e01824
y.create.l HWIO_APPS_SMMU_CBAR10_APPS_ADDR A:0x61e01028
y.create.l HWIO_APPS_SMMU_CBFRSYNRA10_APPS_ADDR A:0x61e01428
y.create.l HWIO_APPS_SMMU_CBA2R10_APPS_ADDR A:0x61e01828
y.create.l HWIO_APPS_SMMU_CBAR11_APPS_ADDR A:0x61e0102c
y.create.l HWIO_APPS_SMMU_CBFRSYNRA11_APPS_ADDR A:0x61e0142c
y.create.l HWIO_APPS_SMMU_CBA2R11_APPS_ADDR A:0x61e0182c
y.create.l HWIO_APPS_SMMU_CBAR12_APPS_ADDR A:0x61e01030
y.create.l HWIO_APPS_SMMU_CBFRSYNRA12_APPS_ADDR A:0x61e01430
y.create.l HWIO_APPS_SMMU_CBA2R12_APPS_ADDR A:0x61e01830
y.create.l HWIO_APPS_SMMU_CBAR13_APPS_ADDR A:0x61e01034
y.create.l HWIO_APPS_SMMU_CBFRSYNRA13_APPS_ADDR A:0x61e01434
y.create.l HWIO_APPS_SMMU_CBA2R13_APPS_ADDR A:0x61e01834
y.create.l HWIO_APPS_SMMU_CBAR14_APPS_ADDR A:0x61e01038
y.create.l HWIO_APPS_SMMU_CBFRSYNRA14_APPS_ADDR A:0x61e01438
y.create.l HWIO_APPS_SMMU_CBA2R14_APPS_ADDR A:0x61e01838
y.create.l HWIO_APPS_SMMU_CBAR15_APPS_ADDR A:0x61e0103c
y.create.l HWIO_APPS_SMMU_CBFRSYNRA15_APPS_ADDR A:0x61e0143c
y.create.l HWIO_APPS_SMMU_CBA2R15_APPS_ADDR A:0x61e0183c
y.create.l HWIO_APPS_SMMU_ITCTRL_APPS_ADDR A:0x61e02000
y.create.l HWIO_APPS_SMMU_ITIP_APPS_ADDR A:0x61e02004
y.create.l HWIO_APPS_SMMU_ITOP_GLBL_APPS_ADDR A:0x61e02008
y.create.l HWIO_APPS_SMMU_ITOP_PERF_INDEX_APPS_ADDR A:0x61e0200c
y.create.l HWIO_APPS_SMMU_ITOP_CXT0TO31_RAM0_APPS_ADDR A:0x61e02010
y.create.l HWIO_APPS_SMMU_TBUQOS0_APPS_ADDR A:0x61e02100
y.create.l HWIO_APPS_SMMU_PER_APPS_ADDR A:0x61e02200
y.create.l HWIO_APPS_SMMU_TBU_PWR_STATUS_APPS_ADDR A:0x61e02204
y.create.l HWIO_APPS_PMEVCNTR0_APPS_ADDR A:0x61e03000
y.create.l HWIO_APPS_PMEVCNTR1_APPS_ADDR A:0x61e03004
y.create.l HWIO_APPS_PMEVCNTR2_APPS_ADDR A:0x61e03008
y.create.l HWIO_APPS_PMEVCNTR3_APPS_ADDR A:0x61e0300c
y.create.l HWIO_APPS_PMEVCNTR4_APPS_ADDR A:0x61e03010
y.create.l HWIO_APPS_PMEVCNTR5_APPS_ADDR A:0x61e03014
y.create.l HWIO_APPS_PMEVCNTR6_APPS_ADDR A:0x61e03018
y.create.l HWIO_APPS_PMEVCNTR7_APPS_ADDR A:0x61e0301c
y.create.l HWIO_APPS_PMEVCNTR8_APPS_ADDR A:0x61e03020
y.create.l HWIO_APPS_PMEVCNTR9_APPS_ADDR A:0x61e03024
y.create.l HWIO_APPS_PMEVCNTR10_APPS_ADDR A:0x61e03028
y.create.l HWIO_APPS_PMEVCNTR11_APPS_ADDR A:0x61e0302c
y.create.l HWIO_APPS_PMEVTYPER0_APPS_ADDR A:0x61e03400
y.create.l HWIO_APPS_PMEVTYPER1_APPS_ADDR A:0x61e03404
y.create.l HWIO_APPS_PMEVTYPER2_APPS_ADDR A:0x61e03408
y.create.l HWIO_APPS_PMEVTYPER3_APPS_ADDR A:0x61e0340c
y.create.l HWIO_APPS_PMEVTYPER4_APPS_ADDR A:0x61e03410
y.create.l HWIO_APPS_PMEVTYPER5_APPS_ADDR A:0x61e03414
y.create.l HWIO_APPS_PMEVTYPER6_APPS_ADDR A:0x61e03418
y.create.l HWIO_APPS_PMEVTYPER7_APPS_ADDR A:0x61e0341c
y.create.l HWIO_APPS_PMEVTYPER8_APPS_ADDR A:0x61e03420
y.create.l HWIO_APPS_PMEVTYPER9_APPS_ADDR A:0x61e03424
y.create.l HWIO_APPS_PMEVTYPER10_APPS_ADDR A:0x61e03428
y.create.l HWIO_APPS_PMEVTYPER11_APPS_ADDR A:0x61e0342c
y.create.l HWIO_APPS_PMCGCR0_APPS_ADDR A:0x61e03800
y.create.l HWIO_APPS_PMCGCR1_APPS_ADDR A:0x61e03804
y.create.l HWIO_APPS_PMCGCR2_APPS_ADDR A:0x61e03808
y.create.l HWIO_APPS_PMCGSMR0_APPS_ADDR A:0x61e03a00
y.create.l HWIO_APPS_PMCGSMR1_APPS_ADDR A:0x61e03a04
y.create.l HWIO_APPS_PMCGSMR2_APPS_ADDR A:0x61e03a08
y.create.l HWIO_APPS_PMCNTENSET_APPS_ADDR A:0x61e03c00
y.create.l HWIO_APPS_PMCNTENCLR_APPS_ADDR A:0x61e03c20
y.create.l HWIO_APPS_PMINTENSET_APPS_ADDR A:0x61e03c40
y.create.l HWIO_APPS_PMINTENCLR_APPS_ADDR A:0x61e03c60
y.create.l HWIO_APPS_PMOVSCLR_APPS_ADDR A:0x61e03c80
y.create.l HWIO_APPS_PMOVSSET_APPS_ADDR A:0x61e03cc0
y.create.l HWIO_APPS_PMCFGR_APPS_ADDR A:0x61e03e00
y.create.l HWIO_APPS_PMCR_APPS_ADDR A:0x61e03e04
y.create.l HWIO_APPS_PMCEID0_APPS_ADDR A:0x61e03e20
y.create.l HWIO_APPS_PMAUTHSTATUS_APPS_ADDR A:0x61e03fb8
y.create.l HWIO_APPS_PMDEVTYPE_APPS_ADDR A:0x61e03fcc
y.create.l HWIO_APPS_SMMU_SSD_REG_0_APPS_ADDR A:0x61e04000
y.create.l HWIO_APPS_SMMU_SSD_REG_1_APPS_ADDR A:0x61e04004
y.create.l HWIO_APPS_SMMU_SSD_REG_2_APPS_ADDR A:0x61e04008
y.create.l HWIO_APPS_SMMU_SSD_REG_3_APPS_ADDR A:0x61e0400c
y.create.l HWIO_APPS_SMMU_SSD_REG_4_APPS_ADDR A:0x61e04010
y.create.l HWIO_APPS_SMMU_SSD_REG_5_APPS_ADDR A:0x61e04014
y.create.l HWIO_APPS_SMMU_SSD_REG_6_APPS_ADDR A:0x61e04018
y.create.l HWIO_APPS_SMMU_SSD_REG_7_APPS_ADDR A:0x61e0401c
y.create.l HWIO_APPS_SMMU_SSD_REG_8_APPS_ADDR A:0x61e04020
y.create.l HWIO_APPS_SMMU_SSD_REG_9_APPS_ADDR A:0x61e04024
y.create.l HWIO_APPS_SMMU_SSD_REG_10_APPS_ADDR A:0x61e04028
y.create.l HWIO_APPS_SMMU_SSD_REG_11_APPS_ADDR A:0x61e0402c
y.create.l HWIO_APPS_SMMU_SSD_REG_12_APPS_ADDR A:0x61e04030
y.create.l HWIO_APPS_SMMU_SSD_REG_13_APPS_ADDR A:0x61e04034
y.create.l HWIO_APPS_SMMU_SSD_REG_14_APPS_ADDR A:0x61e04038
y.create.l HWIO_APPS_SMMU_SSD_REG_15_APPS_ADDR A:0x61e0403c
y.create.l HWIO_APPS_SMMU_SSD_REG_16_APPS_ADDR A:0x61e04040
y.create.l HWIO_APPS_SMMU_SSD_REG_17_APPS_ADDR A:0x61e04044
y.create.l HWIO_APPS_SMMU_SSD_REG_18_APPS_ADDR A:0x61e04048
y.create.l HWIO_APPS_SMMU_SSD_REG_19_APPS_ADDR A:0x61e0404c
y.create.l HWIO_APPS_SMMU_SSD_REG_20_APPS_ADDR A:0x61e04050
y.create.l HWIO_APPS_SMMU_SSD_REG_21_APPS_ADDR A:0x61e04054
y.create.l HWIO_APPS_SMMU_SSD_REG_22_APPS_ADDR A:0x61e04058
y.create.l HWIO_APPS_SMMU_SSD_REG_23_APPS_ADDR A:0x61e0405c
y.create.l HWIO_APPS_SMMU_SSD_REG_24_APPS_ADDR A:0x61e04060
y.create.l HWIO_APPS_SMMU_SSD_REG_25_APPS_ADDR A:0x61e04064
y.create.l HWIO_APPS_SMMU_SSD_REG_26_APPS_ADDR A:0x61e04068
y.create.l HWIO_APPS_SMMU_SSD_REG_27_APPS_ADDR A:0x61e0406c
y.create.l HWIO_APPS_SMMU_SSD_REG_28_APPS_ADDR A:0x61e04070
y.create.l HWIO_APPS_SMMU_SSD_REG_29_APPS_ADDR A:0x61e04074
y.create.l HWIO_APPS_SMMU_SSD_REG_30_APPS_ADDR A:0x61e04078
y.create.l HWIO_APPS_SMMU_SSD_REG_31_APPS_ADDR A:0x61e0407c
y.create.l HWIO_APPS_SMMU_SSD_REG_32_APPS_ADDR A:0x61e04080
y.create.l HWIO_APPS_SMMU_SSD_REG_33_APPS_ADDR A:0x61e04084
y.create.l HWIO_APPS_SMMU_SSD_REG_34_APPS_ADDR A:0x61e04088
y.create.l HWIO_APPS_SMMU_SSD_REG_35_APPS_ADDR A:0x61e0408c
y.create.l HWIO_APPS_SMMU_SSD_REG_36_APPS_ADDR A:0x61e04090
y.create.l HWIO_APPS_SMMU_SSD_REG_37_APPS_ADDR A:0x61e04094
y.create.l HWIO_APPS_SMMU_SSD_REG_38_APPS_ADDR A:0x61e04098
y.create.l HWIO_APPS_SMMU_SSD_REG_39_APPS_ADDR A:0x61e0409c
y.create.l HWIO_APPS_SMMU_SSD_REG_40_APPS_ADDR A:0x61e040a0
y.create.l HWIO_APPS_SMMU_SSD_REG_41_APPS_ADDR A:0x61e040a4
y.create.l HWIO_APPS_SMMU_SSD_REG_42_APPS_ADDR A:0x61e040a8
y.create.l HWIO_APPS_SMMU_SSD_REG_43_APPS_ADDR A:0x61e040ac
y.create.l HWIO_APPS_SMMU_SSD_REG_44_APPS_ADDR A:0x61e040b0
y.create.l HWIO_APPS_SMMU_SSD_REG_45_APPS_ADDR A:0x61e040b4
y.create.l HWIO_APPS_SMMU_SSD_REG_46_APPS_ADDR A:0x61e040b8
y.create.l HWIO_APPS_SMMU_SSD_REG_47_APPS_ADDR A:0x61e040bc
y.create.l HWIO_APPS_SMMU_SSD_REG_48_APPS_ADDR A:0x61e040c0
y.create.l HWIO_APPS_SMMU_SSD_REG_49_APPS_ADDR A:0x61e040c4
y.create.l HWIO_APPS_SMMU_SSD_REG_50_APPS_ADDR A:0x61e040c8
y.create.l HWIO_APPS_SMMU_SSD_REG_51_APPS_ADDR A:0x61e040cc
y.create.l HWIO_APPS_SMMU_SSD_REG_52_APPS_ADDR A:0x61e040d0
y.create.l HWIO_APPS_SMMU_SSD_REG_53_APPS_ADDR A:0x61e040d4
y.create.l HWIO_APPS_SMMU_SSD_REG_54_APPS_ADDR A:0x61e040d8
y.create.l HWIO_APPS_SMMU_SSD_REG_55_APPS_ADDR A:0x61e040dc
y.create.l HWIO_APPS_SMMU_SSD_REG_56_APPS_ADDR A:0x61e040e0
y.create.l HWIO_APPS_SMMU_SSD_REG_57_APPS_ADDR A:0x61e040e4
y.create.l HWIO_APPS_SMMU_SSD_REG_58_APPS_ADDR A:0x61e040e8
y.create.l HWIO_APPS_SMMU_SSD_REG_59_APPS_ADDR A:0x61e040ec
y.create.l HWIO_APPS_SMMU_SSD_REG_60_APPS_ADDR A:0x61e040f0
y.create.l HWIO_APPS_SMMU_SSD_REG_61_APPS_ADDR A:0x61e040f4
y.create.l HWIO_APPS_SMMU_SSD_REG_62_APPS_ADDR A:0x61e040f8
y.create.l HWIO_APPS_SMMU_SSD_REG_63_APPS_ADDR A:0x61e040fc
y.create.l HWIO_APPS_SMMU_SSD_REG_64_APPS_ADDR A:0x61e04100
y.create.l HWIO_APPS_SMMU_SSD_REG_65_APPS_ADDR A:0x61e04104
y.create.l HWIO_APPS_SMMU_SSD_REG_66_APPS_ADDR A:0x61e04108
y.create.l HWIO_APPS_SMMU_SSD_REG_67_APPS_ADDR A:0x61e0410c
y.create.l HWIO_APPS_SMMU_SSD_REG_68_APPS_ADDR A:0x61e04110
y.create.l HWIO_APPS_SMMU_SSD_REG_69_APPS_ADDR A:0x61e04114
y.create.l HWIO_APPS_SMMU_SSD_REG_70_APPS_ADDR A:0x61e04118
y.create.l HWIO_APPS_SMMU_SSD_REG_71_APPS_ADDR A:0x61e0411c
y.create.l HWIO_APPS_SMMU_SSD_REG_72_APPS_ADDR A:0x61e04120
y.create.l HWIO_APPS_SMMU_SSD_REG_73_APPS_ADDR A:0x61e04124
y.create.l HWIO_APPS_SMMU_SSD_REG_74_APPS_ADDR A:0x61e04128
y.create.l HWIO_APPS_SMMU_SSD_REG_75_APPS_ADDR A:0x61e0412c
y.create.l HWIO_APPS_SMMU_SSD_REG_76_APPS_ADDR A:0x61e04130
y.create.l HWIO_APPS_SMMU_SSD_REG_77_APPS_ADDR A:0x61e04134
y.create.l HWIO_APPS_SMMU_SSD_REG_78_APPS_ADDR A:0x61e04138
y.create.l HWIO_APPS_SMMU_SSD_REG_79_APPS_ADDR A:0x61e0413c
y.create.l HWIO_APPS_SMMU_SSD_REG_80_APPS_ADDR A:0x61e04140
y.create.l HWIO_APPS_SMMU_SSD_REG_81_APPS_ADDR A:0x61e04144
y.create.l HWIO_APPS_SMMU_SSD_REG_82_APPS_ADDR A:0x61e04148
y.create.l HWIO_APPS_SMMU_SSD_REG_83_APPS_ADDR A:0x61e0414c
y.create.l HWIO_APPS_SMMU_SSD_REG_84_APPS_ADDR A:0x61e04150
y.create.l HWIO_APPS_SMMU_SSD_REG_85_APPS_ADDR A:0x61e04154
y.create.l HWIO_APPS_SMMU_SSD_REG_86_APPS_ADDR A:0x61e04158
y.create.l HWIO_APPS_SMMU_SSD_REG_87_APPS_ADDR A:0x61e0415c
y.create.l HWIO_APPS_SMMU_SSD_REG_88_APPS_ADDR A:0x61e04160
y.create.l HWIO_APPS_SMMU_SSD_REG_89_APPS_ADDR A:0x61e04164
y.create.l HWIO_APPS_SMMU_SSD_REG_90_APPS_ADDR A:0x61e04168
y.create.l HWIO_APPS_SMMU_SSD_REG_91_APPS_ADDR A:0x61e0416c
y.create.l HWIO_APPS_SMMU_SSD_REG_92_APPS_ADDR A:0x61e04170
y.create.l HWIO_APPS_SMMU_SSD_REG_93_APPS_ADDR A:0x61e04174
y.create.l HWIO_APPS_SMMU_SSD_REG_94_APPS_ADDR A:0x61e04178
y.create.l HWIO_APPS_SMMU_SSD_REG_95_APPS_ADDR A:0x61e0417c
y.create.l HWIO_APPS_SMMU_SSD_REG_96_APPS_ADDR A:0x61e04180
y.create.l HWIO_APPS_SMMU_SSD_REG_97_APPS_ADDR A:0x61e04184
y.create.l HWIO_APPS_SMMU_SSD_REG_98_APPS_ADDR A:0x61e04188
y.create.l HWIO_APPS_SMMU_SSD_REG_99_APPS_ADDR A:0x61e0418c
y.create.l HWIO_APPS_SMMU_SSD_REG_100_APPS_ADDR A:0x61e04190
y.create.l HWIO_APPS_SMMU_SSD_REG_101_APPS_ADDR A:0x61e04194
y.create.l HWIO_APPS_SMMU_SSD_REG_102_APPS_ADDR A:0x61e04198
y.create.l HWIO_APPS_SMMU_SSD_REG_103_APPS_ADDR A:0x61e0419c
y.create.l HWIO_APPS_SMMU_SSD_REG_104_APPS_ADDR A:0x61e041a0
y.create.l HWIO_APPS_SMMU_SSD_REG_105_APPS_ADDR A:0x61e041a4
y.create.l HWIO_APPS_SMMU_SSD_REG_106_APPS_ADDR A:0x61e041a8
y.create.l HWIO_APPS_SMMU_SSD_REG_107_APPS_ADDR A:0x61e041ac
y.create.l HWIO_APPS_SMMU_SSD_REG_108_APPS_ADDR A:0x61e041b0
y.create.l HWIO_APPS_SMMU_SSD_REG_109_APPS_ADDR A:0x61e041b4
y.create.l HWIO_APPS_SMMU_SSD_REG_110_APPS_ADDR A:0x61e041b8
y.create.l HWIO_APPS_SMMU_SSD_REG_111_APPS_ADDR A:0x61e041bc
y.create.l HWIO_APPS_SMMU_SSD_REG_112_APPS_ADDR A:0x61e041c0
y.create.l HWIO_APPS_SMMU_SSD_REG_113_APPS_ADDR A:0x61e041c4
y.create.l HWIO_APPS_SMMU_SSD_REG_114_APPS_ADDR A:0x61e041c8
y.create.l HWIO_APPS_SMMU_SSD_REG_115_APPS_ADDR A:0x61e041cc
y.create.l HWIO_APPS_SMMU_SSD_REG_116_APPS_ADDR A:0x61e041d0
y.create.l HWIO_APPS_SMMU_SSD_REG_117_APPS_ADDR A:0x61e041d4
y.create.l HWIO_APPS_SMMU_SSD_REG_118_APPS_ADDR A:0x61e041d8
y.create.l HWIO_APPS_SMMU_SSD_REG_119_APPS_ADDR A:0x61e041dc
y.create.l HWIO_APPS_SMMU_SSD_REG_120_APPS_ADDR A:0x61e041e0
y.create.l HWIO_APPS_SMMU_SSD_REG_121_APPS_ADDR A:0x61e041e4
y.create.l HWIO_APPS_SMMU_SSD_REG_122_APPS_ADDR A:0x61e041e8
y.create.l HWIO_APPS_SMMU_SSD_REG_123_APPS_ADDR A:0x61e041ec
y.create.l HWIO_APPS_SMMU_SSD_REG_124_APPS_ADDR A:0x61e041f0
y.create.l HWIO_APPS_SMMU_SSD_REG_125_APPS_ADDR A:0x61e041f4
y.create.l HWIO_APPS_SMMU_SSD_REG_126_APPS_ADDR A:0x61e041f8
y.create.l HWIO_APPS_SMMU_SSD_REG_127_APPS_ADDR A:0x61e041fc
y.create.l HWIO_APPS_SMMU_SSD_REG_128_APPS_ADDR A:0x61e04200
y.create.l HWIO_APPS_SMMU_SSD_REG_129_APPS_ADDR A:0x61e04204
y.create.l HWIO_APPS_SMMU_SSD_REG_130_APPS_ADDR A:0x61e04208
y.create.l HWIO_APPS_SMMU_SSD_REG_131_APPS_ADDR A:0x61e0420c
y.create.l HWIO_APPS_SMMU_SSD_REG_132_APPS_ADDR A:0x61e04210
y.create.l HWIO_APPS_SMMU_SSD_REG_133_APPS_ADDR A:0x61e04214
y.create.l HWIO_APPS_SMMU_SSD_REG_134_APPS_ADDR A:0x61e04218
y.create.l HWIO_APPS_SMMU_SSD_REG_135_APPS_ADDR A:0x61e0421c
y.create.l HWIO_APPS_SMMU_SSD_REG_136_APPS_ADDR A:0x61e04220
y.create.l HWIO_APPS_SMMU_SSD_REG_137_APPS_ADDR A:0x61e04224
y.create.l HWIO_APPS_SMMU_SSD_REG_138_APPS_ADDR A:0x61e04228
y.create.l HWIO_APPS_SMMU_SSD_REG_139_APPS_ADDR A:0x61e0422c
y.create.l HWIO_APPS_SMMU_SSD_REG_140_APPS_ADDR A:0x61e04230
y.create.l HWIO_APPS_SMMU_SSD_REG_141_APPS_ADDR A:0x61e04234
y.create.l HWIO_APPS_SMMU_SSD_REG_142_APPS_ADDR A:0x61e04238
y.create.l HWIO_APPS_SMMU_SSD_REG_143_APPS_ADDR A:0x61e0423c
y.create.l HWIO_APPS_SMMU_SSD_REG_144_APPS_ADDR A:0x61e04240
y.create.l HWIO_APPS_SMMU_SSD_REG_145_APPS_ADDR A:0x61e04244
y.create.l HWIO_APPS_SMMU_SSD_REG_146_APPS_ADDR A:0x61e04248
y.create.l HWIO_APPS_SMMU_SSD_REG_147_APPS_ADDR A:0x61e0424c
y.create.l HWIO_APPS_SMMU_SSD_REG_148_APPS_ADDR A:0x61e04250
y.create.l HWIO_APPS_SMMU_SSD_REG_149_APPS_ADDR A:0x61e04254
y.create.l HWIO_APPS_SMMU_SSD_REG_150_APPS_ADDR A:0x61e04258
y.create.l HWIO_APPS_SMMU_SSD_REG_151_APPS_ADDR A:0x61e0425c
y.create.l HWIO_APPS_SMMU_SSD_REG_152_APPS_ADDR A:0x61e04260
y.create.l HWIO_APPS_SMMU_SSD_REG_153_APPS_ADDR A:0x61e04264
y.create.l HWIO_APPS_SMMU_SSD_REG_154_APPS_ADDR A:0x61e04268
y.create.l HWIO_APPS_SMMU_SSD_REG_155_APPS_ADDR A:0x61e0426c
y.create.l HWIO_APPS_SMMU_SSD_REG_156_APPS_ADDR A:0x61e04270
y.create.l HWIO_APPS_SMMU_SSD_REG_157_APPS_ADDR A:0x61e04274
y.create.l HWIO_APPS_SMMU_SSD_REG_158_APPS_ADDR A:0x61e04278
y.create.l HWIO_APPS_SMMU_SSD_REG_159_APPS_ADDR A:0x61e0427c
y.create.l HWIO_APPS_SMMU_SSD_REG_160_APPS_ADDR A:0x61e04280
y.create.l HWIO_APPS_SMMU_SSD_REG_161_APPS_ADDR A:0x61e04284
y.create.l HWIO_APPS_SMMU_SSD_REG_162_APPS_ADDR A:0x61e04288
y.create.l HWIO_APPS_SMMU_SSD_REG_163_APPS_ADDR A:0x61e0428c
y.create.l HWIO_APPS_SMMU_SSD_REG_164_APPS_ADDR A:0x61e04290
y.create.l HWIO_APPS_SMMU_SSD_REG_165_APPS_ADDR A:0x61e04294
y.create.l HWIO_APPS_SMMU_SSD_REG_166_APPS_ADDR A:0x61e04298
y.create.l HWIO_APPS_SMMU_SSD_REG_167_APPS_ADDR A:0x61e0429c
y.create.l HWIO_APPS_SMMU_SSD_REG_168_APPS_ADDR A:0x61e042a0
y.create.l HWIO_APPS_SMMU_SSD_REG_169_APPS_ADDR A:0x61e042a4
y.create.l HWIO_APPS_SMMU_SSD_REG_170_APPS_ADDR A:0x61e042a8
y.create.l HWIO_APPS_SMMU_SSD_REG_171_APPS_ADDR A:0x61e042ac
y.create.l HWIO_APPS_SMMU_SSD_REG_172_APPS_ADDR A:0x61e042b0
y.create.l HWIO_APPS_SMMU_SSD_REG_173_APPS_ADDR A:0x61e042b4
y.create.l HWIO_APPS_SMMU_SSD_REG_174_APPS_ADDR A:0x61e042b8
y.create.l HWIO_APPS_SMMU_SSD_REG_175_APPS_ADDR A:0x61e042bc
y.create.l HWIO_APPS_SMMU_SSD_REG_176_APPS_ADDR A:0x61e042c0
y.create.l HWIO_APPS_SMMU_SSD_REG_177_APPS_ADDR A:0x61e042c4
y.create.l HWIO_APPS_SMMU_SSD_REG_178_APPS_ADDR A:0x61e042c8
y.create.l HWIO_APPS_SMMU_SSD_REG_179_APPS_ADDR A:0x61e042cc
y.create.l HWIO_APPS_SMMU_SSD_REG_180_APPS_ADDR A:0x61e042d0
y.create.l HWIO_APPS_SMMU_SSD_REG_181_APPS_ADDR A:0x61e042d4
y.create.l HWIO_APPS_SMMU_SSD_REG_182_APPS_ADDR A:0x61e042d8
y.create.l HWIO_APPS_SMMU_SSD_REG_183_APPS_ADDR A:0x61e042dc
y.create.l HWIO_APPS_SMMU_SSD_REG_184_APPS_ADDR A:0x61e042e0
y.create.l HWIO_APPS_SMMU_SSD_REG_185_APPS_ADDR A:0x61e042e4
y.create.l HWIO_APPS_SMMU_SSD_REG_186_APPS_ADDR A:0x61e042e8
y.create.l HWIO_APPS_SMMU_SSD_REG_187_APPS_ADDR A:0x61e042ec
y.create.l HWIO_APPS_SMMU_SSD_REG_188_APPS_ADDR A:0x61e042f0
y.create.l HWIO_APPS_SMMU_SSD_REG_189_APPS_ADDR A:0x61e042f4
y.create.l HWIO_APPS_SMMU_SSD_REG_190_APPS_ADDR A:0x61e042f8
y.create.l HWIO_APPS_SMMU_SSD_REG_191_APPS_ADDR A:0x61e042fc
y.create.l HWIO_APPS_SMMU_SSD_REG_192_APPS_ADDR A:0x61e04300
y.create.l HWIO_APPS_SMMU_SSD_REG_193_APPS_ADDR A:0x61e04304
y.create.l HWIO_APPS_SMMU_SSD_REG_194_APPS_ADDR A:0x61e04308
y.create.l HWIO_APPS_SMMU_SSD_REG_195_APPS_ADDR A:0x61e0430c
y.create.l HWIO_APPS_SMMU_SSD_REG_196_APPS_ADDR A:0x61e04310
y.create.l HWIO_APPS_SMMU_SSD_REG_197_APPS_ADDR A:0x61e04314
y.create.l HWIO_APPS_SMMU_SSD_REG_198_APPS_ADDR A:0x61e04318
y.create.l HWIO_APPS_SMMU_SSD_REG_199_APPS_ADDR A:0x61e0431c
y.create.l HWIO_APPS_SMMU_SSD_REG_200_APPS_ADDR A:0x61e04320
y.create.l HWIO_APPS_SMMU_SSD_REG_201_APPS_ADDR A:0x61e04324
y.create.l HWIO_APPS_SMMU_SSD_REG_202_APPS_ADDR A:0x61e04328
y.create.l HWIO_APPS_SMMU_SSD_REG_203_APPS_ADDR A:0x61e0432c
y.create.l HWIO_APPS_SMMU_SSD_REG_204_APPS_ADDR A:0x61e04330
y.create.l HWIO_APPS_SMMU_SSD_REG_205_APPS_ADDR A:0x61e04334
y.create.l HWIO_APPS_SMMU_SSD_REG_206_APPS_ADDR A:0x61e04338
y.create.l HWIO_APPS_SMMU_SSD_REG_207_APPS_ADDR A:0x61e0433c
y.create.l HWIO_APPS_SMMU_SSD_REG_208_APPS_ADDR A:0x61e04340
y.create.l HWIO_APPS_SMMU_SSD_REG_209_APPS_ADDR A:0x61e04344
y.create.l HWIO_APPS_SMMU_SSD_REG_210_APPS_ADDR A:0x61e04348
y.create.l HWIO_APPS_SMMU_SSD_REG_211_APPS_ADDR A:0x61e0434c
y.create.l HWIO_APPS_SMMU_SSD_REG_212_APPS_ADDR A:0x61e04350
y.create.l HWIO_APPS_SMMU_SSD_REG_213_APPS_ADDR A:0x61e04354
y.create.l HWIO_APPS_SMMU_SSD_REG_214_APPS_ADDR A:0x61e04358
y.create.l HWIO_APPS_SMMU_SSD_REG_215_APPS_ADDR A:0x61e0435c
y.create.l HWIO_APPS_SMMU_SSD_REG_216_APPS_ADDR A:0x61e04360
y.create.l HWIO_APPS_SMMU_SSD_REG_217_APPS_ADDR A:0x61e04364
y.create.l HWIO_APPS_SMMU_SSD_REG_218_APPS_ADDR A:0x61e04368
y.create.l HWIO_APPS_SMMU_SSD_REG_219_APPS_ADDR A:0x61e0436c
y.create.l HWIO_APPS_SMMU_SSD_REG_220_APPS_ADDR A:0x61e04370
y.create.l HWIO_APPS_SMMU_SSD_REG_221_APPS_ADDR A:0x61e04374
y.create.l HWIO_APPS_SMMU_SSD_REG_222_APPS_ADDR A:0x61e04378
y.create.l HWIO_APPS_SMMU_SSD_REG_223_APPS_ADDR A:0x61e0437c
y.create.l HWIO_APPS_SMMU_SSD_REG_224_APPS_ADDR A:0x61e04380
y.create.l HWIO_APPS_SMMU_SSD_REG_225_APPS_ADDR A:0x61e04384
y.create.l HWIO_APPS_SMMU_SSD_REG_226_APPS_ADDR A:0x61e04388
y.create.l HWIO_APPS_SMMU_SSD_REG_227_APPS_ADDR A:0x61e0438c
y.create.l HWIO_APPS_SMMU_SSD_REG_228_APPS_ADDR A:0x61e04390
y.create.l HWIO_APPS_SMMU_SSD_REG_229_APPS_ADDR A:0x61e04394
y.create.l HWIO_APPS_SMMU_SSD_REG_230_APPS_ADDR A:0x61e04398
y.create.l HWIO_APPS_SMMU_SSD_REG_231_APPS_ADDR A:0x61e0439c
y.create.l HWIO_APPS_SMMU_SSD_REG_232_APPS_ADDR A:0x61e043a0
y.create.l HWIO_APPS_SMMU_SSD_REG_233_APPS_ADDR A:0x61e043a4
y.create.l HWIO_APPS_SMMU_SSD_REG_234_APPS_ADDR A:0x61e043a8
y.create.l HWIO_APPS_SMMU_SSD_REG_235_APPS_ADDR A:0x61e043ac
y.create.l HWIO_APPS_SMMU_SSD_REG_236_APPS_ADDR A:0x61e043b0
y.create.l HWIO_APPS_SMMU_SSD_REG_237_APPS_ADDR A:0x61e043b4
y.create.l HWIO_APPS_SMMU_SSD_REG_238_APPS_ADDR A:0x61e043b8
y.create.l HWIO_APPS_SMMU_SSD_REG_239_APPS_ADDR A:0x61e043bc
y.create.l HWIO_APPS_SMMU_SSD_REG_240_APPS_ADDR A:0x61e043c0
y.create.l HWIO_APPS_SMMU_SSD_REG_241_APPS_ADDR A:0x61e043c4
y.create.l HWIO_APPS_SMMU_SSD_REG_242_APPS_ADDR A:0x61e043c8
y.create.l HWIO_APPS_SMMU_SSD_REG_243_APPS_ADDR A:0x61e043cc
y.create.l HWIO_APPS_SMMU_SSD_REG_244_APPS_ADDR A:0x61e043d0
y.create.l HWIO_APPS_SMMU_SSD_REG_245_APPS_ADDR A:0x61e043d4
y.create.l HWIO_APPS_SMMU_SSD_REG_246_APPS_ADDR A:0x61e043d8
y.create.l HWIO_APPS_SMMU_SSD_REG_247_APPS_ADDR A:0x61e043dc
y.create.l HWIO_APPS_SMMU_SSD_REG_248_APPS_ADDR A:0x61e043e0
y.create.l HWIO_APPS_SMMU_SSD_REG_249_APPS_ADDR A:0x61e043e4
y.create.l HWIO_APPS_SMMU_SSD_REG_250_APPS_ADDR A:0x61e043e8
y.create.l HWIO_APPS_SMMU_SSD_REG_251_APPS_ADDR A:0x61e043ec
y.create.l HWIO_APPS_SMMU_SSD_REG_252_APPS_ADDR A:0x61e043f0
y.create.l HWIO_APPS_SMMU_SSD_REG_253_APPS_ADDR A:0x61e043f4
y.create.l HWIO_APPS_SMMU_SSD_REG_254_APPS_ADDR A:0x61e043f8
y.create.l HWIO_APPS_SMMU_SSD_REG_255_APPS_ADDR A:0x61e043fc
y.create.l HWIO_APPS_SMMU_SSD_REG_256_APPS_ADDR A:0x61e04400
y.create.l HWIO_APPS_SMMU_SSD_REG_257_APPS_ADDR A:0x61e04404
y.create.l HWIO_APPS_SMMU_SSD_REG_258_APPS_ADDR A:0x61e04408
y.create.l HWIO_APPS_SMMU_SSD_REG_259_APPS_ADDR A:0x61e0440c
y.create.l HWIO_APPS_SMMU_SSD_REG_260_APPS_ADDR A:0x61e04410
y.create.l HWIO_APPS_SMMU_SSD_REG_261_APPS_ADDR A:0x61e04414
y.create.l HWIO_APPS_SMMU_SSD_REG_262_APPS_ADDR A:0x61e04418
y.create.l HWIO_APPS_SMMU_SSD_REG_263_APPS_ADDR A:0x61e0441c
y.create.l HWIO_APPS_SMMU_SSD_REG_264_APPS_ADDR A:0x61e04420
y.create.l HWIO_APPS_SMMU_SSD_REG_265_APPS_ADDR A:0x61e04424
y.create.l HWIO_APPS_SMMU_SSD_REG_266_APPS_ADDR A:0x61e04428
y.create.l HWIO_APPS_SMMU_SSD_REG_267_APPS_ADDR A:0x61e0442c
y.create.l HWIO_APPS_SMMU_SSD_REG_268_APPS_ADDR A:0x61e04430
y.create.l HWIO_APPS_SMMU_SSD_REG_269_APPS_ADDR A:0x61e04434
y.create.l HWIO_APPS_SMMU_SSD_REG_270_APPS_ADDR A:0x61e04438
y.create.l HWIO_APPS_SMMU_SSD_REG_271_APPS_ADDR A:0x61e0443c
y.create.l HWIO_APPS_SMMU_SSD_REG_272_APPS_ADDR A:0x61e04440
y.create.l HWIO_APPS_SMMU_SSD_REG_273_APPS_ADDR A:0x61e04444
y.create.l HWIO_APPS_SMMU_SSD_REG_274_APPS_ADDR A:0x61e04448
y.create.l HWIO_APPS_SMMU_SSD_REG_275_APPS_ADDR A:0x61e0444c
y.create.l HWIO_APPS_SMMU_SSD_REG_276_APPS_ADDR A:0x61e04450
y.create.l HWIO_APPS_SMMU_SSD_REG_277_APPS_ADDR A:0x61e04454
y.create.l HWIO_APPS_SMMU_SSD_REG_278_APPS_ADDR A:0x61e04458
y.create.l HWIO_APPS_SMMU_SSD_REG_279_APPS_ADDR A:0x61e0445c
y.create.l HWIO_APPS_SMMU_SSD_REG_280_APPS_ADDR A:0x61e04460
y.create.l HWIO_APPS_SMMU_SSD_REG_281_APPS_ADDR A:0x61e04464
y.create.l HWIO_APPS_SMMU_SSD_REG_282_APPS_ADDR A:0x61e04468
y.create.l HWIO_APPS_SMMU_SSD_REG_283_APPS_ADDR A:0x61e0446c
y.create.l HWIO_APPS_SMMU_SSD_REG_284_APPS_ADDR A:0x61e04470
y.create.l HWIO_APPS_SMMU_SSD_REG_285_APPS_ADDR A:0x61e04474
y.create.l HWIO_APPS_SMMU_SSD_REG_286_APPS_ADDR A:0x61e04478
y.create.l HWIO_APPS_SMMU_SSD_REG_287_APPS_ADDR A:0x61e0447c
y.create.l HWIO_APPS_SMMU_SSD_REG_288_APPS_ADDR A:0x61e04480
y.create.l HWIO_APPS_SMMU_SSD_REG_289_APPS_ADDR A:0x61e04484
y.create.l HWIO_APPS_SMMU_SSD_REG_290_APPS_ADDR A:0x61e04488
y.create.l HWIO_APPS_SMMU_SSD_REG_291_APPS_ADDR A:0x61e0448c
y.create.l HWIO_APPS_SMMU_SSD_REG_292_APPS_ADDR A:0x61e04490
y.create.l HWIO_APPS_SMMU_SSD_REG_293_APPS_ADDR A:0x61e04494
y.create.l HWIO_APPS_SMMU_SSD_REG_294_APPS_ADDR A:0x61e04498
y.create.l HWIO_APPS_SMMU_SSD_REG_295_APPS_ADDR A:0x61e0449c
y.create.l HWIO_APPS_SMMU_SSD_REG_296_APPS_ADDR A:0x61e044a0
y.create.l HWIO_APPS_SMMU_SSD_REG_297_APPS_ADDR A:0x61e044a4
y.create.l HWIO_APPS_SMMU_SSD_REG_298_APPS_ADDR A:0x61e044a8
y.create.l HWIO_APPS_SMMU_SSD_REG_299_APPS_ADDR A:0x61e044ac
y.create.l HWIO_APPS_SMMU_SSD_REG_300_APPS_ADDR A:0x61e044b0
y.create.l HWIO_APPS_SMMU_SSD_REG_301_APPS_ADDR A:0x61e044b4
y.create.l HWIO_APPS_SMMU_SSD_REG_302_APPS_ADDR A:0x61e044b8
y.create.l HWIO_APPS_SMMU_SSD_REG_303_APPS_ADDR A:0x61e044bc
y.create.l HWIO_APPS_SMMU_SSD_REG_304_APPS_ADDR A:0x61e044c0
y.create.l HWIO_APPS_SMMU_SSD_REG_305_APPS_ADDR A:0x61e044c4
y.create.l HWIO_APPS_SMMU_SSD_REG_306_APPS_ADDR A:0x61e044c8
y.create.l HWIO_APPS_SMMU_SSD_REG_307_APPS_ADDR A:0x61e044cc
y.create.l HWIO_APPS_SMMU_SSD_REG_308_APPS_ADDR A:0x61e044d0
y.create.l HWIO_APPS_SMMU_SSD_REG_309_APPS_ADDR A:0x61e044d4
y.create.l HWIO_APPS_SMMU_SSD_REG_310_APPS_ADDR A:0x61e044d8
y.create.l HWIO_APPS_SMMU_SSD_REG_311_APPS_ADDR A:0x61e044dc
y.create.l HWIO_APPS_SMMU_SSD_REG_312_APPS_ADDR A:0x61e044e0
y.create.l HWIO_APPS_SMMU_SSD_REG_313_APPS_ADDR A:0x61e044e4
y.create.l HWIO_APPS_SMMU_SSD_REG_314_APPS_ADDR A:0x61e044e8
y.create.l HWIO_APPS_SMMU_SSD_REG_315_APPS_ADDR A:0x61e044ec
y.create.l HWIO_APPS_SMMU_SSD_REG_316_APPS_ADDR A:0x61e044f0
y.create.l HWIO_APPS_SMMU_SSD_REG_317_APPS_ADDR A:0x61e044f4
y.create.l HWIO_APPS_SMMU_SSD_REG_318_APPS_ADDR A:0x61e044f8
y.create.l HWIO_APPS_SMMU_SSD_REG_319_APPS_ADDR A:0x61e044fc
y.create.l HWIO_APPS_SMMU_SSD_REG_320_APPS_ADDR A:0x61e04500
y.create.l HWIO_APPS_SMMU_SSD_REG_321_APPS_ADDR A:0x61e04504
y.create.l HWIO_APPS_SMMU_SSD_REG_322_APPS_ADDR A:0x61e04508
y.create.l HWIO_APPS_SMMU_SSD_REG_323_APPS_ADDR A:0x61e0450c
y.create.l HWIO_APPS_SMMU_SSD_REG_324_APPS_ADDR A:0x61e04510
y.create.l HWIO_APPS_SMMU_SSD_REG_325_APPS_ADDR A:0x61e04514
y.create.l HWIO_APPS_SMMU_SSD_REG_326_APPS_ADDR A:0x61e04518
y.create.l HWIO_APPS_SMMU_SSD_REG_327_APPS_ADDR A:0x61e0451c
y.create.l HWIO_APPS_SMMU_SSD_REG_328_APPS_ADDR A:0x61e04520
y.create.l HWIO_APPS_SMMU_SSD_REG_329_APPS_ADDR A:0x61e04524
y.create.l HWIO_APPS_SMMU_SSD_REG_330_APPS_ADDR A:0x61e04528
y.create.l HWIO_APPS_SMMU_SSD_REG_331_APPS_ADDR A:0x61e0452c
y.create.l HWIO_APPS_SMMU_SSD_REG_332_APPS_ADDR A:0x61e04530
y.create.l HWIO_APPS_SMMU_SSD_REG_333_APPS_ADDR A:0x61e04534
y.create.l HWIO_APPS_SMMU_SSD_REG_334_APPS_ADDR A:0x61e04538
y.create.l HWIO_APPS_SMMU_SSD_REG_335_APPS_ADDR A:0x61e0453c
y.create.l HWIO_APPS_SMMU_SSD_REG_336_APPS_ADDR A:0x61e04540
y.create.l HWIO_APPS_SMMU_SSD_REG_337_APPS_ADDR A:0x61e04544
y.create.l HWIO_APPS_SMMU_SSD_REG_338_APPS_ADDR A:0x61e04548
y.create.l HWIO_APPS_SMMU_SSD_REG_339_APPS_ADDR A:0x61e0454c
y.create.l HWIO_APPS_SMMU_SSD_REG_340_APPS_ADDR A:0x61e04550
y.create.l HWIO_APPS_SMMU_SSD_REG_341_APPS_ADDR A:0x61e04554
y.create.l HWIO_APPS_SMMU_SSD_REG_342_APPS_ADDR A:0x61e04558
y.create.l HWIO_APPS_SMMU_SSD_REG_343_APPS_ADDR A:0x61e0455c
y.create.l HWIO_APPS_SMMU_SSD_REG_344_APPS_ADDR A:0x61e04560
y.create.l HWIO_APPS_SMMU_SSD_REG_345_APPS_ADDR A:0x61e04564
y.create.l HWIO_APPS_SMMU_SSD_REG_346_APPS_ADDR A:0x61e04568
y.create.l HWIO_APPS_SMMU_SSD_REG_347_APPS_ADDR A:0x61e0456c
y.create.l HWIO_APPS_SMMU_SSD_REG_348_APPS_ADDR A:0x61e04570
y.create.l HWIO_APPS_SMMU_SSD_REG_349_APPS_ADDR A:0x61e04574
y.create.l HWIO_APPS_SMMU_SSD_REG_350_APPS_ADDR A:0x61e04578
y.create.l HWIO_APPS_SMMU_SSD_REG_351_APPS_ADDR A:0x61e0457c
y.create.l HWIO_APPS_SMMU_SSD_REG_352_APPS_ADDR A:0x61e04580
y.create.l HWIO_APPS_SMMU_SSD_REG_353_APPS_ADDR A:0x61e04584
y.create.l HWIO_APPS_SMMU_SSD_REG_354_APPS_ADDR A:0x61e04588
y.create.l HWIO_APPS_SMMU_SSD_REG_355_APPS_ADDR A:0x61e0458c
y.create.l HWIO_APPS_SMMU_SSD_REG_356_APPS_ADDR A:0x61e04590
y.create.l HWIO_APPS_SMMU_SSD_REG_357_APPS_ADDR A:0x61e04594
y.create.l HWIO_APPS_SMMU_SSD_REG_358_APPS_ADDR A:0x61e04598
y.create.l HWIO_APPS_SMMU_SSD_REG_359_APPS_ADDR A:0x61e0459c
y.create.l HWIO_APPS_SMMU_SSD_REG_360_APPS_ADDR A:0x61e045a0
y.create.l HWIO_APPS_SMMU_SSD_REG_361_APPS_ADDR A:0x61e045a4
y.create.l HWIO_APPS_SMMU_SSD_REG_362_APPS_ADDR A:0x61e045a8
y.create.l HWIO_APPS_SMMU_SSD_REG_363_APPS_ADDR A:0x61e045ac
y.create.l HWIO_APPS_SMMU_SSD_REG_364_APPS_ADDR A:0x61e045b0
y.create.l HWIO_APPS_SMMU_SSD_REG_365_APPS_ADDR A:0x61e045b4
y.create.l HWIO_APPS_SMMU_SSD_REG_366_APPS_ADDR A:0x61e045b8
y.create.l HWIO_APPS_SMMU_SSD_REG_367_APPS_ADDR A:0x61e045bc
y.create.l HWIO_APPS_SMMU_SSD_REG_368_APPS_ADDR A:0x61e045c0
y.create.l HWIO_APPS_SMMU_SSD_REG_369_APPS_ADDR A:0x61e045c4
y.create.l HWIO_APPS_SMMU_SSD_REG_370_APPS_ADDR A:0x61e045c8
y.create.l HWIO_APPS_SMMU_SSD_REG_371_APPS_ADDR A:0x61e045cc
y.create.l HWIO_APPS_SMMU_SSD_REG_372_APPS_ADDR A:0x61e045d0
y.create.l HWIO_APPS_SMMU_SSD_REG_373_APPS_ADDR A:0x61e045d4
y.create.l HWIO_APPS_SMMU_SSD_REG_374_APPS_ADDR A:0x61e045d8
y.create.l HWIO_APPS_SMMU_SSD_REG_375_APPS_ADDR A:0x61e045dc
y.create.l HWIO_APPS_SMMU_SSD_REG_376_APPS_ADDR A:0x61e045e0
y.create.l HWIO_APPS_SMMU_SSD_REG_377_APPS_ADDR A:0x61e045e4
y.create.l HWIO_APPS_SMMU_SSD_REG_378_APPS_ADDR A:0x61e045e8
y.create.l HWIO_APPS_SMMU_SSD_REG_379_APPS_ADDR A:0x61e045ec
y.create.l HWIO_APPS_SMMU_SSD_REG_380_APPS_ADDR A:0x61e045f0
y.create.l HWIO_APPS_SMMU_SSD_REG_381_APPS_ADDR A:0x61e045f4
y.create.l HWIO_APPS_SMMU_SSD_REG_382_APPS_ADDR A:0x61e045f8
y.create.l HWIO_APPS_SMMU_SSD_REG_383_APPS_ADDR A:0x61e045fc
y.create.l HWIO_APPS_SMMU_SSD_REG_384_APPS_ADDR A:0x61e04600
y.create.l HWIO_APPS_SMMU_SSD_REG_385_APPS_ADDR A:0x61e04604
y.create.l HWIO_APPS_SMMU_SSD_REG_386_APPS_ADDR A:0x61e04608
y.create.l HWIO_APPS_SMMU_SSD_REG_387_APPS_ADDR A:0x61e0460c
y.create.l HWIO_APPS_SMMU_SSD_REG_388_APPS_ADDR A:0x61e04610
y.create.l HWIO_APPS_SMMU_SSD_REG_389_APPS_ADDR A:0x61e04614
y.create.l HWIO_APPS_SMMU_SSD_REG_390_APPS_ADDR A:0x61e04618
y.create.l HWIO_APPS_SMMU_SSD_REG_391_APPS_ADDR A:0x61e0461c
y.create.l HWIO_APPS_SMMU_SSD_REG_392_APPS_ADDR A:0x61e04620
y.create.l HWIO_APPS_SMMU_SSD_REG_393_APPS_ADDR A:0x61e04624
y.create.l HWIO_APPS_SMMU_SSD_REG_394_APPS_ADDR A:0x61e04628
y.create.l HWIO_APPS_SMMU_SSD_REG_395_APPS_ADDR A:0x61e0462c
y.create.l HWIO_APPS_SMMU_SSD_REG_396_APPS_ADDR A:0x61e04630
y.create.l HWIO_APPS_SMMU_SSD_REG_397_APPS_ADDR A:0x61e04634
y.create.l HWIO_APPS_SMMU_SSD_REG_398_APPS_ADDR A:0x61e04638
y.create.l HWIO_APPS_SMMU_SSD_REG_399_APPS_ADDR A:0x61e0463c
y.create.l HWIO_APPS_SMMU_SSD_REG_400_APPS_ADDR A:0x61e04640
y.create.l HWIO_APPS_SMMU_SSD_REG_401_APPS_ADDR A:0x61e04644
y.create.l HWIO_APPS_SMMU_SSD_REG_402_APPS_ADDR A:0x61e04648
y.create.l HWIO_APPS_SMMU_SSD_REG_403_APPS_ADDR A:0x61e0464c
y.create.l HWIO_APPS_SMMU_SSD_REG_404_APPS_ADDR A:0x61e04650
y.create.l HWIO_APPS_SMMU_SSD_REG_405_APPS_ADDR A:0x61e04654
y.create.l HWIO_APPS_SMMU_SSD_REG_406_APPS_ADDR A:0x61e04658
y.create.l HWIO_APPS_SMMU_SSD_REG_407_APPS_ADDR A:0x61e0465c
y.create.l HWIO_APPS_SMMU_SSD_REG_408_APPS_ADDR A:0x61e04660
y.create.l HWIO_APPS_SMMU_SSD_REG_409_APPS_ADDR A:0x61e04664
y.create.l HWIO_APPS_SMMU_SSD_REG_410_APPS_ADDR A:0x61e04668
y.create.l HWIO_APPS_SMMU_SSD_REG_411_APPS_ADDR A:0x61e0466c
y.create.l HWIO_APPS_SMMU_SSD_REG_412_APPS_ADDR A:0x61e04670
y.create.l HWIO_APPS_SMMU_SSD_REG_413_APPS_ADDR A:0x61e04674
y.create.l HWIO_APPS_SMMU_SSD_REG_414_APPS_ADDR A:0x61e04678
y.create.l HWIO_APPS_SMMU_SSD_REG_415_APPS_ADDR A:0x61e0467c
y.create.l HWIO_APPS_SMMU_SSD_REG_416_APPS_ADDR A:0x61e04680
y.create.l HWIO_APPS_SMMU_SSD_REG_417_APPS_ADDR A:0x61e04684
y.create.l HWIO_APPS_SMMU_SSD_REG_418_APPS_ADDR A:0x61e04688
y.create.l HWIO_APPS_SMMU_SSD_REG_419_APPS_ADDR A:0x61e0468c
y.create.l HWIO_APPS_SMMU_SSD_REG_420_APPS_ADDR A:0x61e04690
y.create.l HWIO_APPS_SMMU_SSD_REG_421_APPS_ADDR A:0x61e04694
y.create.l HWIO_APPS_SMMU_SSD_REG_422_APPS_ADDR A:0x61e04698
y.create.l HWIO_APPS_SMMU_SSD_REG_423_APPS_ADDR A:0x61e0469c
y.create.l HWIO_APPS_SMMU_SSD_REG_424_APPS_ADDR A:0x61e046a0
y.create.l HWIO_APPS_SMMU_SSD_REG_425_APPS_ADDR A:0x61e046a4
y.create.l HWIO_APPS_SMMU_SSD_REG_426_APPS_ADDR A:0x61e046a8
y.create.l HWIO_APPS_SMMU_SSD_REG_427_APPS_ADDR A:0x61e046ac
y.create.l HWIO_APPS_SMMU_SSD_REG_428_APPS_ADDR A:0x61e046b0
y.create.l HWIO_APPS_SMMU_SSD_REG_429_APPS_ADDR A:0x61e046b4
y.create.l HWIO_APPS_SMMU_SSD_REG_430_APPS_ADDR A:0x61e046b8
y.create.l HWIO_APPS_SMMU_SSD_REG_431_APPS_ADDR A:0x61e046bc
y.create.l HWIO_APPS_SMMU_SSD_REG_432_APPS_ADDR A:0x61e046c0
y.create.l HWIO_APPS_SMMU_SSD_REG_433_APPS_ADDR A:0x61e046c4
y.create.l HWIO_APPS_SMMU_SSD_REG_434_APPS_ADDR A:0x61e046c8
y.create.l HWIO_APPS_SMMU_SSD_REG_435_APPS_ADDR A:0x61e046cc
y.create.l HWIO_APPS_SMMU_SSD_REG_436_APPS_ADDR A:0x61e046d0
y.create.l HWIO_APPS_SMMU_SSD_REG_437_APPS_ADDR A:0x61e046d4
y.create.l HWIO_APPS_SMMU_SSD_REG_438_APPS_ADDR A:0x61e046d8
y.create.l HWIO_APPS_SMMU_SSD_REG_439_APPS_ADDR A:0x61e046dc
y.create.l HWIO_APPS_SMMU_SSD_REG_440_APPS_ADDR A:0x61e046e0
y.create.l HWIO_APPS_SMMU_SSD_REG_441_APPS_ADDR A:0x61e046e4
y.create.l HWIO_APPS_SMMU_SSD_REG_442_APPS_ADDR A:0x61e046e8
y.create.l HWIO_APPS_SMMU_SSD_REG_443_APPS_ADDR A:0x61e046ec
y.create.l HWIO_APPS_SMMU_SSD_REG_444_APPS_ADDR A:0x61e046f0
y.create.l HWIO_APPS_SMMU_SSD_REG_445_APPS_ADDR A:0x61e046f4
y.create.l HWIO_APPS_SMMU_SSD_REG_446_APPS_ADDR A:0x61e046f8
y.create.l HWIO_APPS_SMMU_SSD_REG_447_APPS_ADDR A:0x61e046fc
y.create.l HWIO_APPS_SMMU_SSD_REG_448_APPS_ADDR A:0x61e04700
y.create.l HWIO_APPS_SMMU_SSD_REG_449_APPS_ADDR A:0x61e04704
y.create.l HWIO_APPS_SMMU_SSD_REG_450_APPS_ADDR A:0x61e04708
y.create.l HWIO_APPS_SMMU_SSD_REG_451_APPS_ADDR A:0x61e0470c
y.create.l HWIO_APPS_SMMU_SSD_REG_452_APPS_ADDR A:0x61e04710
y.create.l HWIO_APPS_SMMU_SSD_REG_453_APPS_ADDR A:0x61e04714
y.create.l HWIO_APPS_SMMU_SSD_REG_454_APPS_ADDR A:0x61e04718
y.create.l HWIO_APPS_SMMU_SSD_REG_455_APPS_ADDR A:0x61e0471c
y.create.l HWIO_APPS_SMMU_SSD_REG_456_APPS_ADDR A:0x61e04720
y.create.l HWIO_APPS_SMMU_SSD_REG_457_APPS_ADDR A:0x61e04724
y.create.l HWIO_APPS_SMMU_SSD_REG_458_APPS_ADDR A:0x61e04728
y.create.l HWIO_APPS_SMMU_SSD_REG_459_APPS_ADDR A:0x61e0472c
y.create.l HWIO_APPS_SMMU_SSD_REG_460_APPS_ADDR A:0x61e04730
y.create.l HWIO_APPS_SMMU_SSD_REG_461_APPS_ADDR A:0x61e04734
y.create.l HWIO_APPS_SMMU_SSD_REG_462_APPS_ADDR A:0x61e04738
y.create.l HWIO_APPS_SMMU_SSD_REG_463_APPS_ADDR A:0x61e0473c
y.create.l HWIO_APPS_SMMU_SSD_REG_464_APPS_ADDR A:0x61e04740
y.create.l HWIO_APPS_SMMU_SSD_REG_465_APPS_ADDR A:0x61e04744
y.create.l HWIO_APPS_SMMU_SSD_REG_466_APPS_ADDR A:0x61e04748
y.create.l HWIO_APPS_SMMU_SSD_REG_467_APPS_ADDR A:0x61e0474c
y.create.l HWIO_APPS_SMMU_SSD_REG_468_APPS_ADDR A:0x61e04750
y.create.l HWIO_APPS_SMMU_SSD_REG_469_APPS_ADDR A:0x61e04754
y.create.l HWIO_APPS_SMMU_SSD_REG_470_APPS_ADDR A:0x61e04758
y.create.l HWIO_APPS_SMMU_SSD_REG_471_APPS_ADDR A:0x61e0475c
y.create.l HWIO_APPS_SMMU_SSD_REG_472_APPS_ADDR A:0x61e04760
y.create.l HWIO_APPS_SMMU_SSD_REG_473_APPS_ADDR A:0x61e04764
y.create.l HWIO_APPS_SMMU_SSD_REG_474_APPS_ADDR A:0x61e04768
y.create.l HWIO_APPS_SMMU_SSD_REG_475_APPS_ADDR A:0x61e0476c
y.create.l HWIO_APPS_SMMU_SSD_REG_476_APPS_ADDR A:0x61e04770
y.create.l HWIO_APPS_SMMU_SSD_REG_477_APPS_ADDR A:0x61e04774
y.create.l HWIO_APPS_SMMU_SSD_REG_478_APPS_ADDR A:0x61e04778
y.create.l HWIO_APPS_SMMU_SSD_REG_479_APPS_ADDR A:0x61e0477c
y.create.l HWIO_APPS_SMMU_SSD_REG_480_APPS_ADDR A:0x61e04780
y.create.l HWIO_APPS_SMMU_SSD_REG_481_APPS_ADDR A:0x61e04784
y.create.l HWIO_APPS_SMMU_SSD_REG_482_APPS_ADDR A:0x61e04788
y.create.l HWIO_APPS_SMMU_SSD_REG_483_APPS_ADDR A:0x61e0478c
y.create.l HWIO_APPS_SMMU_SSD_REG_484_APPS_ADDR A:0x61e04790
y.create.l HWIO_APPS_SMMU_SSD_REG_485_APPS_ADDR A:0x61e04794
y.create.l HWIO_APPS_SMMU_SSD_REG_486_APPS_ADDR A:0x61e04798
y.create.l HWIO_APPS_SMMU_SSD_REG_487_APPS_ADDR A:0x61e0479c
y.create.l HWIO_APPS_SMMU_SSD_REG_488_APPS_ADDR A:0x61e047a0
y.create.l HWIO_APPS_SMMU_SSD_REG_489_APPS_ADDR A:0x61e047a4
y.create.l HWIO_APPS_SMMU_SSD_REG_490_APPS_ADDR A:0x61e047a8
y.create.l HWIO_APPS_SMMU_SSD_REG_491_APPS_ADDR A:0x61e047ac
y.create.l HWIO_APPS_SMMU_SSD_REG_492_APPS_ADDR A:0x61e047b0
y.create.l HWIO_APPS_SMMU_SSD_REG_493_APPS_ADDR A:0x61e047b4
y.create.l HWIO_APPS_SMMU_SSD_REG_494_APPS_ADDR A:0x61e047b8
y.create.l HWIO_APPS_SMMU_SSD_REG_495_APPS_ADDR A:0x61e047bc
y.create.l HWIO_APPS_SMMU_SSD_REG_496_APPS_ADDR A:0x61e047c0
y.create.l HWIO_APPS_SMMU_SSD_REG_497_APPS_ADDR A:0x61e047c4
y.create.l HWIO_APPS_SMMU_SSD_REG_498_APPS_ADDR A:0x61e047c8
y.create.l HWIO_APPS_SMMU_SSD_REG_499_APPS_ADDR A:0x61e047cc
y.create.l HWIO_APPS_SMMU_SSD_REG_500_APPS_ADDR A:0x61e047d0
y.create.l HWIO_APPS_SMMU_SSD_REG_501_APPS_ADDR A:0x61e047d4
y.create.l HWIO_APPS_SMMU_SSD_REG_502_APPS_ADDR A:0x61e047d8
y.create.l HWIO_APPS_SMMU_SSD_REG_503_APPS_ADDR A:0x61e047dc
y.create.l HWIO_APPS_SMMU_SSD_REG_504_APPS_ADDR A:0x61e047e0
y.create.l HWIO_APPS_SMMU_SSD_REG_505_APPS_ADDR A:0x61e047e4
y.create.l HWIO_APPS_SMMU_SSD_REG_506_APPS_ADDR A:0x61e047e8
y.create.l HWIO_APPS_SMMU_SSD_REG_507_APPS_ADDR A:0x61e047ec
y.create.l HWIO_APPS_SMMU_SSD_REG_508_APPS_ADDR A:0x61e047f0
y.create.l HWIO_APPS_SMMU_SSD_REG_509_APPS_ADDR A:0x61e047f4
y.create.l HWIO_APPS_SMMU_SSD_REG_510_APPS_ADDR A:0x61e047f8
y.create.l HWIO_APPS_SMMU_SSD_REG_511_APPS_ADDR A:0x61e047fc
y.create.l HWIO_APPS_SMMU_SSD_REG_512_APPS_ADDR A:0x61e04800
y.create.l HWIO_APPS_SMMU_SSD_REG_513_APPS_ADDR A:0x61e04804
y.create.l HWIO_APPS_SMMU_SSD_REG_514_APPS_ADDR A:0x61e04808
y.create.l HWIO_APPS_SMMU_SSD_REG_515_APPS_ADDR A:0x61e0480c
y.create.l HWIO_APPS_SMMU_SSD_REG_516_APPS_ADDR A:0x61e04810
y.create.l HWIO_APPS_SMMU_SSD_REG_517_APPS_ADDR A:0x61e04814
y.create.l HWIO_APPS_SMMU_SSD_REG_518_APPS_ADDR A:0x61e04818
y.create.l HWIO_APPS_SMMU_SSD_REG_519_APPS_ADDR A:0x61e0481c
y.create.l HWIO_APPS_SMMU_SSD_REG_520_APPS_ADDR A:0x61e04820
y.create.l HWIO_APPS_SMMU_SSD_REG_521_APPS_ADDR A:0x61e04824
y.create.l HWIO_APPS_SMMU_SSD_REG_522_APPS_ADDR A:0x61e04828
y.create.l HWIO_APPS_SMMU_SSD_REG_523_APPS_ADDR A:0x61e0482c
y.create.l HWIO_APPS_SMMU_SSD_REG_524_APPS_ADDR A:0x61e04830
y.create.l HWIO_APPS_SMMU_SSD_REG_525_APPS_ADDR A:0x61e04834
y.create.l HWIO_APPS_SMMU_SSD_REG_526_APPS_ADDR A:0x61e04838
y.create.l HWIO_APPS_SMMU_SSD_REG_527_APPS_ADDR A:0x61e0483c
y.create.l HWIO_APPS_SMMU_SSD_REG_528_APPS_ADDR A:0x61e04840
y.create.l HWIO_APPS_SMMU_SSD_REG_529_APPS_ADDR A:0x61e04844
y.create.l HWIO_APPS_SMMU_SSD_REG_530_APPS_ADDR A:0x61e04848
y.create.l HWIO_APPS_SMMU_SSD_REG_531_APPS_ADDR A:0x61e0484c
y.create.l HWIO_APPS_SMMU_SSD_REG_532_APPS_ADDR A:0x61e04850
y.create.l HWIO_APPS_SMMU_SSD_REG_533_APPS_ADDR A:0x61e04854
y.create.l HWIO_APPS_SMMU_SSD_REG_534_APPS_ADDR A:0x61e04858
y.create.l HWIO_APPS_SMMU_SSD_REG_535_APPS_ADDR A:0x61e0485c
y.create.l HWIO_APPS_SMMU_SSD_REG_536_APPS_ADDR A:0x61e04860
y.create.l HWIO_APPS_SMMU_SSD_REG_537_APPS_ADDR A:0x61e04864
y.create.l HWIO_APPS_SMMU_SSD_REG_538_APPS_ADDR A:0x61e04868
y.create.l HWIO_APPS_SMMU_SSD_REG_539_APPS_ADDR A:0x61e0486c
y.create.l HWIO_APPS_SMMU_SSD_REG_540_APPS_ADDR A:0x61e04870
y.create.l HWIO_APPS_SMMU_SSD_REG_541_APPS_ADDR A:0x61e04874
y.create.l HWIO_APPS_SMMU_SSD_REG_542_APPS_ADDR A:0x61e04878
y.create.l HWIO_APPS_SMMU_SSD_REG_543_APPS_ADDR A:0x61e0487c
y.create.l HWIO_APPS_SMMU_SSD_REG_544_APPS_ADDR A:0x61e04880
y.create.l HWIO_APPS_SMMU_SSD_REG_545_APPS_ADDR A:0x61e04884
y.create.l HWIO_APPS_SMMU_SSD_REG_546_APPS_ADDR A:0x61e04888
y.create.l HWIO_APPS_SMMU_SSD_REG_547_APPS_ADDR A:0x61e0488c
y.create.l HWIO_APPS_SMMU_SSD_REG_548_APPS_ADDR A:0x61e04890
y.create.l HWIO_APPS_SMMU_SSD_REG_549_APPS_ADDR A:0x61e04894
y.create.l HWIO_APPS_SMMU_SSD_REG_550_APPS_ADDR A:0x61e04898
y.create.l HWIO_APPS_SMMU_SSD_REG_551_APPS_ADDR A:0x61e0489c
y.create.l HWIO_APPS_SMMU_SSD_REG_552_APPS_ADDR A:0x61e048a0
y.create.l HWIO_APPS_SMMU_SSD_REG_553_APPS_ADDR A:0x61e048a4
y.create.l HWIO_APPS_SMMU_SSD_REG_554_APPS_ADDR A:0x61e048a8
y.create.l HWIO_APPS_SMMU_SSD_REG_555_APPS_ADDR A:0x61e048ac
y.create.l HWIO_APPS_SMMU_SSD_REG_556_APPS_ADDR A:0x61e048b0
y.create.l HWIO_APPS_SMMU_SSD_REG_557_APPS_ADDR A:0x61e048b4
y.create.l HWIO_APPS_SMMU_SSD_REG_558_APPS_ADDR A:0x61e048b8
y.create.l HWIO_APPS_SMMU_SSD_REG_559_APPS_ADDR A:0x61e048bc
y.create.l HWIO_APPS_SMMU_SSD_REG_560_APPS_ADDR A:0x61e048c0
y.create.l HWIO_APPS_SMMU_SSD_REG_561_APPS_ADDR A:0x61e048c4
y.create.l HWIO_APPS_SMMU_SSD_REG_562_APPS_ADDR A:0x61e048c8
y.create.l HWIO_APPS_SMMU_SSD_REG_563_APPS_ADDR A:0x61e048cc
y.create.l HWIO_APPS_SMMU_SSD_REG_564_APPS_ADDR A:0x61e048d0
y.create.l HWIO_APPS_SMMU_SSD_REG_565_APPS_ADDR A:0x61e048d4
y.create.l HWIO_APPS_SMMU_SSD_REG_566_APPS_ADDR A:0x61e048d8
y.create.l HWIO_APPS_SMMU_SSD_REG_567_APPS_ADDR A:0x61e048dc
y.create.l HWIO_APPS_SMMU_SSD_REG_568_APPS_ADDR A:0x61e048e0
y.create.l HWIO_APPS_SMMU_SSD_REG_569_APPS_ADDR A:0x61e048e4
y.create.l HWIO_APPS_SMMU_SSD_REG_570_APPS_ADDR A:0x61e048e8
y.create.l HWIO_APPS_SMMU_SSD_REG_571_APPS_ADDR A:0x61e048ec
y.create.l HWIO_APPS_SMMU_SSD_REG_572_APPS_ADDR A:0x61e048f0
y.create.l HWIO_APPS_SMMU_SSD_REG_573_APPS_ADDR A:0x61e048f4
y.create.l HWIO_APPS_SMMU_SSD_REG_574_APPS_ADDR A:0x61e048f8
y.create.l HWIO_APPS_SMMU_SSD_REG_575_APPS_ADDR A:0x61e048fc
y.create.l HWIO_APPS_SMMU_SSD_REG_576_APPS_ADDR A:0x61e04900
y.create.l HWIO_APPS_SMMU_SSD_REG_577_APPS_ADDR A:0x61e04904
y.create.l HWIO_APPS_SMMU_SSD_REG_578_APPS_ADDR A:0x61e04908
y.create.l HWIO_APPS_SMMU_SSD_REG_579_APPS_ADDR A:0x61e0490c
y.create.l HWIO_APPS_SMMU_SSD_REG_580_APPS_ADDR A:0x61e04910
y.create.l HWIO_APPS_SMMU_SSD_REG_581_APPS_ADDR A:0x61e04914
y.create.l HWIO_APPS_SMMU_SSD_REG_582_APPS_ADDR A:0x61e04918
y.create.l HWIO_APPS_SMMU_SSD_REG_583_APPS_ADDR A:0x61e0491c
y.create.l HWIO_APPS_SMMU_SSD_REG_584_APPS_ADDR A:0x61e04920
y.create.l HWIO_APPS_SMMU_SSD_REG_585_APPS_ADDR A:0x61e04924
y.create.l HWIO_APPS_SMMU_SSD_REG_586_APPS_ADDR A:0x61e04928
y.create.l HWIO_APPS_SMMU_SSD_REG_587_APPS_ADDR A:0x61e0492c
y.create.l HWIO_APPS_SMMU_SSD_REG_588_APPS_ADDR A:0x61e04930
y.create.l HWIO_APPS_SMMU_SSD_REG_589_APPS_ADDR A:0x61e04934
y.create.l HWIO_APPS_SMMU_SSD_REG_590_APPS_ADDR A:0x61e04938
y.create.l HWIO_APPS_SMMU_SSD_REG_591_APPS_ADDR A:0x61e0493c
y.create.l HWIO_APPS_SMMU_SSD_REG_592_APPS_ADDR A:0x61e04940
y.create.l HWIO_APPS_SMMU_SSD_REG_593_APPS_ADDR A:0x61e04944
y.create.l HWIO_APPS_SMMU_SSD_REG_594_APPS_ADDR A:0x61e04948
y.create.l HWIO_APPS_SMMU_SSD_REG_595_APPS_ADDR A:0x61e0494c
y.create.l HWIO_APPS_SMMU_SSD_REG_596_APPS_ADDR A:0x61e04950
y.create.l HWIO_APPS_SMMU_SSD_REG_597_APPS_ADDR A:0x61e04954
y.create.l HWIO_APPS_SMMU_SSD_REG_598_APPS_ADDR A:0x61e04958
y.create.l HWIO_APPS_SMMU_SSD_REG_599_APPS_ADDR A:0x61e0495c
y.create.l HWIO_APPS_SMMU_SSD_REG_600_APPS_ADDR A:0x61e04960
y.create.l HWIO_APPS_SMMU_SSD_REG_601_APPS_ADDR A:0x61e04964
y.create.l HWIO_APPS_SMMU_SSD_REG_602_APPS_ADDR A:0x61e04968
y.create.l HWIO_APPS_SMMU_SSD_REG_603_APPS_ADDR A:0x61e0496c
y.create.l HWIO_APPS_SMMU_SSD_REG_604_APPS_ADDR A:0x61e04970
y.create.l HWIO_APPS_SMMU_SSD_REG_605_APPS_ADDR A:0x61e04974
y.create.l HWIO_APPS_SMMU_SSD_REG_606_APPS_ADDR A:0x61e04978
y.create.l HWIO_APPS_SMMU_SSD_REG_607_APPS_ADDR A:0x61e0497c
y.create.l HWIO_APPS_SMMU_SSD_REG_608_APPS_ADDR A:0x61e04980
y.create.l HWIO_APPS_SMMU_SSD_REG_609_APPS_ADDR A:0x61e04984
y.create.l HWIO_APPS_SMMU_SSD_REG_610_APPS_ADDR A:0x61e04988
y.create.l HWIO_APPS_SMMU_SSD_REG_611_APPS_ADDR A:0x61e0498c
y.create.l HWIO_APPS_SMMU_SSD_REG_612_APPS_ADDR A:0x61e04990
y.create.l HWIO_APPS_SMMU_SSD_REG_613_APPS_ADDR A:0x61e04994
y.create.l HWIO_APPS_SMMU_SSD_REG_614_APPS_ADDR A:0x61e04998
y.create.l HWIO_APPS_SMMU_SSD_REG_615_APPS_ADDR A:0x61e0499c
y.create.l HWIO_APPS_SMMU_SSD_REG_616_APPS_ADDR A:0x61e049a0
y.create.l HWIO_APPS_SMMU_SSD_REG_617_APPS_ADDR A:0x61e049a4
y.create.l HWIO_APPS_SMMU_SSD_REG_618_APPS_ADDR A:0x61e049a8
y.create.l HWIO_APPS_SMMU_SSD_REG_619_APPS_ADDR A:0x61e049ac
y.create.l HWIO_APPS_SMMU_SSD_REG_620_APPS_ADDR A:0x61e049b0
y.create.l HWIO_APPS_SMMU_SSD_REG_621_APPS_ADDR A:0x61e049b4
y.create.l HWIO_APPS_SMMU_SSD_REG_622_APPS_ADDR A:0x61e049b8
y.create.l HWIO_APPS_SMMU_SSD_REG_623_APPS_ADDR A:0x61e049bc
y.create.l HWIO_APPS_SMMU_SSD_REG_624_APPS_ADDR A:0x61e049c0
y.create.l HWIO_APPS_SMMU_SSD_REG_625_APPS_ADDR A:0x61e049c4
y.create.l HWIO_APPS_SMMU_SSD_REG_626_APPS_ADDR A:0x61e049c8
y.create.l HWIO_APPS_SMMU_SSD_REG_627_APPS_ADDR A:0x61e049cc
y.create.l HWIO_APPS_SMMU_SSD_REG_628_APPS_ADDR A:0x61e049d0
y.create.l HWIO_APPS_SMMU_SSD_REG_629_APPS_ADDR A:0x61e049d4
y.create.l HWIO_APPS_SMMU_SSD_REG_630_APPS_ADDR A:0x61e049d8
y.create.l HWIO_APPS_SMMU_SSD_REG_631_APPS_ADDR A:0x61e049dc
y.create.l HWIO_APPS_SMMU_SSD_REG_632_APPS_ADDR A:0x61e049e0
y.create.l HWIO_APPS_SMMU_SSD_REG_633_APPS_ADDR A:0x61e049e4
y.create.l HWIO_APPS_SMMU_SSD_REG_634_APPS_ADDR A:0x61e049e8
y.create.l HWIO_APPS_SMMU_SSD_REG_635_APPS_ADDR A:0x61e049ec
y.create.l HWIO_APPS_SMMU_SSD_REG_636_APPS_ADDR A:0x61e049f0
y.create.l HWIO_APPS_SMMU_SSD_REG_637_APPS_ADDR A:0x61e049f4
y.create.l HWIO_APPS_SMMU_SSD_REG_638_APPS_ADDR A:0x61e049f8
y.create.l HWIO_APPS_SMMU_SSD_REG_639_APPS_ADDR A:0x61e049fc
y.create.l HWIO_APPS_SMMU_SSD_REG_640_APPS_ADDR A:0x61e04a00
y.create.l HWIO_APPS_SMMU_SSD_REG_641_APPS_ADDR A:0x61e04a04
y.create.l HWIO_APPS_SMMU_SSD_REG_642_APPS_ADDR A:0x61e04a08
y.create.l HWIO_APPS_SMMU_SSD_REG_643_APPS_ADDR A:0x61e04a0c
y.create.l HWIO_APPS_SMMU_SSD_REG_644_APPS_ADDR A:0x61e04a10
y.create.l HWIO_APPS_SMMU_SSD_REG_645_APPS_ADDR A:0x61e04a14
y.create.l HWIO_APPS_SMMU_SSD_REG_646_APPS_ADDR A:0x61e04a18
y.create.l HWIO_APPS_SMMU_SSD_REG_647_APPS_ADDR A:0x61e04a1c
y.create.l HWIO_APPS_SMMU_SSD_REG_648_APPS_ADDR A:0x61e04a20
y.create.l HWIO_APPS_SMMU_SSD_REG_649_APPS_ADDR A:0x61e04a24
y.create.l HWIO_APPS_SMMU_SSD_REG_650_APPS_ADDR A:0x61e04a28
y.create.l HWIO_APPS_SMMU_SSD_REG_651_APPS_ADDR A:0x61e04a2c
y.create.l HWIO_APPS_SMMU_SSD_REG_652_APPS_ADDR A:0x61e04a30
y.create.l HWIO_APPS_SMMU_SSD_REG_653_APPS_ADDR A:0x61e04a34
y.create.l HWIO_APPS_SMMU_SSD_REG_654_APPS_ADDR A:0x61e04a38
y.create.l HWIO_APPS_SMMU_SSD_REG_655_APPS_ADDR A:0x61e04a3c
y.create.l HWIO_APPS_SMMU_SSD_REG_656_APPS_ADDR A:0x61e04a40
y.create.l HWIO_APPS_SMMU_SSD_REG_657_APPS_ADDR A:0x61e04a44
y.create.l HWIO_APPS_SMMU_SSD_REG_658_APPS_ADDR A:0x61e04a48
y.create.l HWIO_APPS_SMMU_SSD_REG_659_APPS_ADDR A:0x61e04a4c
y.create.l HWIO_APPS_SMMU_SSD_REG_660_APPS_ADDR A:0x61e04a50
y.create.l HWIO_APPS_SMMU_SSD_REG_661_APPS_ADDR A:0x61e04a54
y.create.l HWIO_APPS_SMMU_SSD_REG_662_APPS_ADDR A:0x61e04a58
y.create.l HWIO_APPS_SMMU_SSD_REG_663_APPS_ADDR A:0x61e04a5c
y.create.l HWIO_APPS_SMMU_SSD_REG_664_APPS_ADDR A:0x61e04a60
y.create.l HWIO_APPS_SMMU_SSD_REG_665_APPS_ADDR A:0x61e04a64
y.create.l HWIO_APPS_SMMU_SSD_REG_666_APPS_ADDR A:0x61e04a68
y.create.l HWIO_APPS_SMMU_SSD_REG_667_APPS_ADDR A:0x61e04a6c
y.create.l HWIO_APPS_SMMU_SSD_REG_668_APPS_ADDR A:0x61e04a70
y.create.l HWIO_APPS_SMMU_SSD_REG_669_APPS_ADDR A:0x61e04a74
y.create.l HWIO_APPS_SMMU_SSD_REG_670_APPS_ADDR A:0x61e04a78
y.create.l HWIO_APPS_SMMU_SSD_REG_671_APPS_ADDR A:0x61e04a7c
y.create.l HWIO_APPS_SMMU_SSD_REG_672_APPS_ADDR A:0x61e04a80
y.create.l HWIO_APPS_SMMU_SSD_REG_673_APPS_ADDR A:0x61e04a84
y.create.l HWIO_APPS_SMMU_SSD_REG_674_APPS_ADDR A:0x61e04a88
y.create.l HWIO_APPS_SMMU_SSD_REG_675_APPS_ADDR A:0x61e04a8c
y.create.l HWIO_APPS_SMMU_SSD_REG_676_APPS_ADDR A:0x61e04a90
y.create.l HWIO_APPS_SMMU_SSD_REG_677_APPS_ADDR A:0x61e04a94
y.create.l HWIO_APPS_SMMU_SSD_REG_678_APPS_ADDR A:0x61e04a98
y.create.l HWIO_APPS_SMMU_SSD_REG_679_APPS_ADDR A:0x61e04a9c
y.create.l HWIO_APPS_SMMU_SSD_REG_680_APPS_ADDR A:0x61e04aa0
y.create.l HWIO_APPS_SMMU_SSD_REG_681_APPS_ADDR A:0x61e04aa4
y.create.l HWIO_APPS_SMMU_SSD_REG_682_APPS_ADDR A:0x61e04aa8
y.create.l HWIO_APPS_SMMU_SSD_REG_683_APPS_ADDR A:0x61e04aac
y.create.l HWIO_APPS_SMMU_SSD_REG_684_APPS_ADDR A:0x61e04ab0
y.create.l HWIO_APPS_SMMU_SSD_REG_685_APPS_ADDR A:0x61e04ab4
y.create.l HWIO_APPS_SMMU_SSD_REG_686_APPS_ADDR A:0x61e04ab8
y.create.l HWIO_APPS_SMMU_SSD_REG_687_APPS_ADDR A:0x61e04abc
y.create.l HWIO_APPS_SMMU_SSD_REG_688_APPS_ADDR A:0x61e04ac0
y.create.l HWIO_APPS_SMMU_SSD_REG_689_APPS_ADDR A:0x61e04ac4
y.create.l HWIO_APPS_SMMU_SSD_REG_690_APPS_ADDR A:0x61e04ac8
y.create.l HWIO_APPS_SMMU_SSD_REG_691_APPS_ADDR A:0x61e04acc
y.create.l HWIO_APPS_SMMU_SSD_REG_692_APPS_ADDR A:0x61e04ad0
y.create.l HWIO_APPS_SMMU_SSD_REG_693_APPS_ADDR A:0x61e04ad4
y.create.l HWIO_APPS_SMMU_SSD_REG_694_APPS_ADDR A:0x61e04ad8
y.create.l HWIO_APPS_SMMU_SSD_REG_695_APPS_ADDR A:0x61e04adc
y.create.l HWIO_APPS_SMMU_SSD_REG_696_APPS_ADDR A:0x61e04ae0
y.create.l HWIO_APPS_SMMU_SSD_REG_697_APPS_ADDR A:0x61e04ae4
y.create.l HWIO_APPS_SMMU_SSD_REG_698_APPS_ADDR A:0x61e04ae8
y.create.l HWIO_APPS_SMMU_SSD_REG_699_APPS_ADDR A:0x61e04aec
y.create.l HWIO_APPS_SMMU_SSD_REG_700_APPS_ADDR A:0x61e04af0
y.create.l HWIO_APPS_SMMU_SSD_REG_701_APPS_ADDR A:0x61e04af4
y.create.l HWIO_APPS_SMMU_SSD_REG_702_APPS_ADDR A:0x61e04af8
y.create.l HWIO_APPS_SMMU_SSD_REG_703_APPS_ADDR A:0x61e04afc
y.create.l HWIO_APPS_SMMU_SSD_REG_704_APPS_ADDR A:0x61e04b00
y.create.l HWIO_APPS_SMMU_SSD_REG_705_APPS_ADDR A:0x61e04b04
y.create.l HWIO_APPS_SMMU_SSD_REG_706_APPS_ADDR A:0x61e04b08
y.create.l HWIO_APPS_SMMU_SSD_REG_707_APPS_ADDR A:0x61e04b0c
y.create.l HWIO_APPS_SMMU_SSD_REG_708_APPS_ADDR A:0x61e04b10
y.create.l HWIO_APPS_SMMU_SSD_REG_709_APPS_ADDR A:0x61e04b14
y.create.l HWIO_APPS_SMMU_SSD_REG_710_APPS_ADDR A:0x61e04b18
y.create.l HWIO_APPS_SMMU_SSD_REG_711_APPS_ADDR A:0x61e04b1c
y.create.l HWIO_APPS_SMMU_SSD_REG_712_APPS_ADDR A:0x61e04b20
y.create.l HWIO_APPS_SMMU_SSD_REG_713_APPS_ADDR A:0x61e04b24
y.create.l HWIO_APPS_SMMU_SSD_REG_714_APPS_ADDR A:0x61e04b28
y.create.l HWIO_APPS_SMMU_SSD_REG_715_APPS_ADDR A:0x61e04b2c
y.create.l HWIO_APPS_SMMU_SSD_REG_716_APPS_ADDR A:0x61e04b30
y.create.l HWIO_APPS_SMMU_SSD_REG_717_APPS_ADDR A:0x61e04b34
y.create.l HWIO_APPS_SMMU_SSD_REG_718_APPS_ADDR A:0x61e04b38
y.create.l HWIO_APPS_SMMU_SSD_REG_719_APPS_ADDR A:0x61e04b3c
y.create.l HWIO_APPS_SMMU_SSD_REG_720_APPS_ADDR A:0x61e04b40
y.create.l HWIO_APPS_SMMU_SSD_REG_721_APPS_ADDR A:0x61e04b44
y.create.l HWIO_APPS_SMMU_SSD_REG_722_APPS_ADDR A:0x61e04b48
y.create.l HWIO_APPS_SMMU_SSD_REG_723_APPS_ADDR A:0x61e04b4c
y.create.l HWIO_APPS_SMMU_SSD_REG_724_APPS_ADDR A:0x61e04b50
y.create.l HWIO_APPS_SMMU_SSD_REG_725_APPS_ADDR A:0x61e04b54
y.create.l HWIO_APPS_SMMU_SSD_REG_726_APPS_ADDR A:0x61e04b58
y.create.l HWIO_APPS_SMMU_SSD_REG_727_APPS_ADDR A:0x61e04b5c
y.create.l HWIO_APPS_SMMU_SSD_REG_728_APPS_ADDR A:0x61e04b60
y.create.l HWIO_APPS_SMMU_SSD_REG_729_APPS_ADDR A:0x61e04b64
y.create.l HWIO_APPS_SMMU_SSD_REG_730_APPS_ADDR A:0x61e04b68
y.create.l HWIO_APPS_SMMU_SSD_REG_731_APPS_ADDR A:0x61e04b6c
y.create.l HWIO_APPS_SMMU_SSD_REG_732_APPS_ADDR A:0x61e04b70
y.create.l HWIO_APPS_SMMU_SSD_REG_733_APPS_ADDR A:0x61e04b74
y.create.l HWIO_APPS_SMMU_SSD_REG_734_APPS_ADDR A:0x61e04b78
y.create.l HWIO_APPS_SMMU_SSD_REG_735_APPS_ADDR A:0x61e04b7c
y.create.l HWIO_APPS_SMMU_SSD_REG_736_APPS_ADDR A:0x61e04b80
y.create.l HWIO_APPS_SMMU_SSD_REG_737_APPS_ADDR A:0x61e04b84
y.create.l HWIO_APPS_SMMU_SSD_REG_738_APPS_ADDR A:0x61e04b88
y.create.l HWIO_APPS_SMMU_SSD_REG_739_APPS_ADDR A:0x61e04b8c
y.create.l HWIO_APPS_SMMU_SSD_REG_740_APPS_ADDR A:0x61e04b90
y.create.l HWIO_APPS_SMMU_SSD_REG_741_APPS_ADDR A:0x61e04b94
y.create.l HWIO_APPS_SMMU_SSD_REG_742_APPS_ADDR A:0x61e04b98
y.create.l HWIO_APPS_SMMU_SSD_REG_743_APPS_ADDR A:0x61e04b9c
y.create.l HWIO_APPS_SMMU_SSD_REG_744_APPS_ADDR A:0x61e04ba0
y.create.l HWIO_APPS_SMMU_SSD_REG_745_APPS_ADDR A:0x61e04ba4
y.create.l HWIO_APPS_SMMU_SSD_REG_746_APPS_ADDR A:0x61e04ba8
y.create.l HWIO_APPS_SMMU_SSD_REG_747_APPS_ADDR A:0x61e04bac
y.create.l HWIO_APPS_SMMU_SSD_REG_748_APPS_ADDR A:0x61e04bb0
y.create.l HWIO_APPS_SMMU_SSD_REG_749_APPS_ADDR A:0x61e04bb4
y.create.l HWIO_APPS_SMMU_SSD_REG_750_APPS_ADDR A:0x61e04bb8
y.create.l HWIO_APPS_SMMU_SSD_REG_751_APPS_ADDR A:0x61e04bbc
y.create.l HWIO_APPS_SMMU_SSD_REG_752_APPS_ADDR A:0x61e04bc0
y.create.l HWIO_APPS_SMMU_SSD_REG_753_APPS_ADDR A:0x61e04bc4
y.create.l HWIO_APPS_SMMU_SSD_REG_754_APPS_ADDR A:0x61e04bc8
y.create.l HWIO_APPS_SMMU_SSD_REG_755_APPS_ADDR A:0x61e04bcc
y.create.l HWIO_APPS_SMMU_SSD_REG_756_APPS_ADDR A:0x61e04bd0
y.create.l HWIO_APPS_SMMU_SSD_REG_757_APPS_ADDR A:0x61e04bd4
y.create.l HWIO_APPS_SMMU_SSD_REG_758_APPS_ADDR A:0x61e04bd8
y.create.l HWIO_APPS_SMMU_SSD_REG_759_APPS_ADDR A:0x61e04bdc
y.create.l HWIO_APPS_SMMU_SSD_REG_760_APPS_ADDR A:0x61e04be0
y.create.l HWIO_APPS_SMMU_SSD_REG_761_APPS_ADDR A:0x61e04be4
y.create.l HWIO_APPS_SMMU_SSD_REG_762_APPS_ADDR A:0x61e04be8
y.create.l HWIO_APPS_SMMU_SSD_REG_763_APPS_ADDR A:0x61e04bec
y.create.l HWIO_APPS_SMMU_SSD_REG_764_APPS_ADDR A:0x61e04bf0
y.create.l HWIO_APPS_SMMU_SSD_REG_765_APPS_ADDR A:0x61e04bf4
y.create.l HWIO_APPS_SMMU_SSD_REG_766_APPS_ADDR A:0x61e04bf8
y.create.l HWIO_APPS_SMMU_SSD_REG_767_APPS_ADDR A:0x61e04bfc
y.create.l HWIO_APPS_SMMU_SSD_REG_768_APPS_ADDR A:0x61e04c00
y.create.l HWIO_APPS_SMMU_SSD_REG_769_APPS_ADDR A:0x61e04c04
y.create.l HWIO_APPS_SMMU_SSD_REG_770_APPS_ADDR A:0x61e04c08
y.create.l HWIO_APPS_SMMU_SSD_REG_771_APPS_ADDR A:0x61e04c0c
y.create.l HWIO_APPS_SMMU_SSD_REG_772_APPS_ADDR A:0x61e04c10
y.create.l HWIO_APPS_SMMU_SSD_REG_773_APPS_ADDR A:0x61e04c14
y.create.l HWIO_APPS_SMMU_SSD_REG_774_APPS_ADDR A:0x61e04c18
y.create.l HWIO_APPS_SMMU_SSD_REG_775_APPS_ADDR A:0x61e04c1c
y.create.l HWIO_APPS_SMMU_SSD_REG_776_APPS_ADDR A:0x61e04c20
y.create.l HWIO_APPS_SMMU_SSD_REG_777_APPS_ADDR A:0x61e04c24
y.create.l HWIO_APPS_SMMU_SSD_REG_778_APPS_ADDR A:0x61e04c28
y.create.l HWIO_APPS_SMMU_SSD_REG_779_APPS_ADDR A:0x61e04c2c
y.create.l HWIO_APPS_SMMU_SSD_REG_780_APPS_ADDR A:0x61e04c30
y.create.l HWIO_APPS_SMMU_SSD_REG_781_APPS_ADDR A:0x61e04c34
y.create.l HWIO_APPS_SMMU_SSD_REG_782_APPS_ADDR A:0x61e04c38
y.create.l HWIO_APPS_SMMU_SSD_REG_783_APPS_ADDR A:0x61e04c3c
y.create.l HWIO_APPS_SMMU_SSD_REG_784_APPS_ADDR A:0x61e04c40
y.create.l HWIO_APPS_SMMU_SSD_REG_785_APPS_ADDR A:0x61e04c44
y.create.l HWIO_APPS_SMMU_SSD_REG_786_APPS_ADDR A:0x61e04c48
y.create.l HWIO_APPS_SMMU_SSD_REG_787_APPS_ADDR A:0x61e04c4c
y.create.l HWIO_APPS_SMMU_SSD_REG_788_APPS_ADDR A:0x61e04c50
y.create.l HWIO_APPS_SMMU_SSD_REG_789_APPS_ADDR A:0x61e04c54
y.create.l HWIO_APPS_SMMU_SSD_REG_790_APPS_ADDR A:0x61e04c58
y.create.l HWIO_APPS_SMMU_SSD_REG_791_APPS_ADDR A:0x61e04c5c
y.create.l HWIO_APPS_SMMU_SSD_REG_792_APPS_ADDR A:0x61e04c60
y.create.l HWIO_APPS_SMMU_SSD_REG_793_APPS_ADDR A:0x61e04c64
y.create.l HWIO_APPS_SMMU_SSD_REG_794_APPS_ADDR A:0x61e04c68
y.create.l HWIO_APPS_SMMU_SSD_REG_795_APPS_ADDR A:0x61e04c6c
y.create.l HWIO_APPS_SMMU_SSD_REG_796_APPS_ADDR A:0x61e04c70
y.create.l HWIO_APPS_SMMU_SSD_REG_797_APPS_ADDR A:0x61e04c74
y.create.l HWIO_APPS_SMMU_SSD_REG_798_APPS_ADDR A:0x61e04c78
y.create.l HWIO_APPS_SMMU_SSD_REG_799_APPS_ADDR A:0x61e04c7c
y.create.l HWIO_APPS_SMMU_SSD_REG_800_APPS_ADDR A:0x61e04c80
y.create.l HWIO_APPS_SMMU_SSD_REG_801_APPS_ADDR A:0x61e04c84
y.create.l HWIO_APPS_SMMU_SSD_REG_802_APPS_ADDR A:0x61e04c88
y.create.l HWIO_APPS_SMMU_SSD_REG_803_APPS_ADDR A:0x61e04c8c
y.create.l HWIO_APPS_SMMU_SSD_REG_804_APPS_ADDR A:0x61e04c90
y.create.l HWIO_APPS_SMMU_SSD_REG_805_APPS_ADDR A:0x61e04c94
y.create.l HWIO_APPS_SMMU_SSD_REG_806_APPS_ADDR A:0x61e04c98
y.create.l HWIO_APPS_SMMU_SSD_REG_807_APPS_ADDR A:0x61e04c9c
y.create.l HWIO_APPS_SMMU_SSD_REG_808_APPS_ADDR A:0x61e04ca0
y.create.l HWIO_APPS_SMMU_SSD_REG_809_APPS_ADDR A:0x61e04ca4
y.create.l HWIO_APPS_SMMU_SSD_REG_810_APPS_ADDR A:0x61e04ca8
y.create.l HWIO_APPS_SMMU_SSD_REG_811_APPS_ADDR A:0x61e04cac
y.create.l HWIO_APPS_SMMU_SSD_REG_812_APPS_ADDR A:0x61e04cb0
y.create.l HWIO_APPS_SMMU_SSD_REG_813_APPS_ADDR A:0x61e04cb4
y.create.l HWIO_APPS_SMMU_SSD_REG_814_APPS_ADDR A:0x61e04cb8
y.create.l HWIO_APPS_SMMU_SSD_REG_815_APPS_ADDR A:0x61e04cbc
y.create.l HWIO_APPS_SMMU_SSD_REG_816_APPS_ADDR A:0x61e04cc0
y.create.l HWIO_APPS_SMMU_SSD_REG_817_APPS_ADDR A:0x61e04cc4
y.create.l HWIO_APPS_SMMU_SSD_REG_818_APPS_ADDR A:0x61e04cc8
y.create.l HWIO_APPS_SMMU_SSD_REG_819_APPS_ADDR A:0x61e04ccc
y.create.l HWIO_APPS_SMMU_SSD_REG_820_APPS_ADDR A:0x61e04cd0
y.create.l HWIO_APPS_SMMU_SSD_REG_821_APPS_ADDR A:0x61e04cd4
y.create.l HWIO_APPS_SMMU_SSD_REG_822_APPS_ADDR A:0x61e04cd8
y.create.l HWIO_APPS_SMMU_SSD_REG_823_APPS_ADDR A:0x61e04cdc
y.create.l HWIO_APPS_SMMU_SSD_REG_824_APPS_ADDR A:0x61e04ce0
y.create.l HWIO_APPS_SMMU_SSD_REG_825_APPS_ADDR A:0x61e04ce4
y.create.l HWIO_APPS_SMMU_SSD_REG_826_APPS_ADDR A:0x61e04ce8
y.create.l HWIO_APPS_SMMU_SSD_REG_827_APPS_ADDR A:0x61e04cec
y.create.l HWIO_APPS_SMMU_SSD_REG_828_APPS_ADDR A:0x61e04cf0
y.create.l HWIO_APPS_SMMU_SSD_REG_829_APPS_ADDR A:0x61e04cf4
y.create.l HWIO_APPS_SMMU_SSD_REG_830_APPS_ADDR A:0x61e04cf8
y.create.l HWIO_APPS_SMMU_SSD_REG_831_APPS_ADDR A:0x61e04cfc
y.create.l HWIO_APPS_SMMU_SSD_REG_832_APPS_ADDR A:0x61e04d00
y.create.l HWIO_APPS_SMMU_SSD_REG_833_APPS_ADDR A:0x61e04d04
y.create.l HWIO_APPS_SMMU_SSD_REG_834_APPS_ADDR A:0x61e04d08
y.create.l HWIO_APPS_SMMU_SSD_REG_835_APPS_ADDR A:0x61e04d0c
y.create.l HWIO_APPS_SMMU_SSD_REG_836_APPS_ADDR A:0x61e04d10
y.create.l HWIO_APPS_SMMU_SSD_REG_837_APPS_ADDR A:0x61e04d14
y.create.l HWIO_APPS_SMMU_SSD_REG_838_APPS_ADDR A:0x61e04d18
y.create.l HWIO_APPS_SMMU_SSD_REG_839_APPS_ADDR A:0x61e04d1c
y.create.l HWIO_APPS_SMMU_SSD_REG_840_APPS_ADDR A:0x61e04d20
y.create.l HWIO_APPS_SMMU_SSD_REG_841_APPS_ADDR A:0x61e04d24
y.create.l HWIO_APPS_SMMU_SSD_REG_842_APPS_ADDR A:0x61e04d28
y.create.l HWIO_APPS_SMMU_SSD_REG_843_APPS_ADDR A:0x61e04d2c
y.create.l HWIO_APPS_SMMU_SSD_REG_844_APPS_ADDR A:0x61e04d30
y.create.l HWIO_APPS_SMMU_SSD_REG_845_APPS_ADDR A:0x61e04d34
y.create.l HWIO_APPS_SMMU_SSD_REG_846_APPS_ADDR A:0x61e04d38
y.create.l HWIO_APPS_SMMU_SSD_REG_847_APPS_ADDR A:0x61e04d3c
y.create.l HWIO_APPS_SMMU_SSD_REG_848_APPS_ADDR A:0x61e04d40
y.create.l HWIO_APPS_SMMU_SSD_REG_849_APPS_ADDR A:0x61e04d44
y.create.l HWIO_APPS_SMMU_SSD_REG_850_APPS_ADDR A:0x61e04d48
y.create.l HWIO_APPS_SMMU_SSD_REG_851_APPS_ADDR A:0x61e04d4c
y.create.l HWIO_APPS_SMMU_SSD_REG_852_APPS_ADDR A:0x61e04d50
y.create.l HWIO_APPS_SMMU_SSD_REG_853_APPS_ADDR A:0x61e04d54
y.create.l HWIO_APPS_SMMU_SSD_REG_854_APPS_ADDR A:0x61e04d58
y.create.l HWIO_APPS_SMMU_SSD_REG_855_APPS_ADDR A:0x61e04d5c
y.create.l HWIO_APPS_SMMU_SSD_REG_856_APPS_ADDR A:0x61e04d60
y.create.l HWIO_APPS_SMMU_SSD_REG_857_APPS_ADDR A:0x61e04d64
y.create.l HWIO_APPS_SMMU_SSD_REG_858_APPS_ADDR A:0x61e04d68
y.create.l HWIO_APPS_SMMU_SSD_REG_859_APPS_ADDR A:0x61e04d6c
y.create.l HWIO_APPS_SMMU_SSD_REG_860_APPS_ADDR A:0x61e04d70
y.create.l HWIO_APPS_SMMU_SSD_REG_861_APPS_ADDR A:0x61e04d74
y.create.l HWIO_APPS_SMMU_SSD_REG_862_APPS_ADDR A:0x61e04d78
y.create.l HWIO_APPS_SMMU_SSD_REG_863_APPS_ADDR A:0x61e04d7c
y.create.l HWIO_APPS_SMMU_SSD_REG_864_APPS_ADDR A:0x61e04d80
y.create.l HWIO_APPS_SMMU_SSD_REG_865_APPS_ADDR A:0x61e04d84
y.create.l HWIO_APPS_SMMU_SSD_REG_866_APPS_ADDR A:0x61e04d88
y.create.l HWIO_APPS_SMMU_SSD_REG_867_APPS_ADDR A:0x61e04d8c
y.create.l HWIO_APPS_SMMU_SSD_REG_868_APPS_ADDR A:0x61e04d90
y.create.l HWIO_APPS_SMMU_SSD_REG_869_APPS_ADDR A:0x61e04d94
y.create.l HWIO_APPS_SMMU_SSD_REG_870_APPS_ADDR A:0x61e04d98
y.create.l HWIO_APPS_SMMU_SSD_REG_871_APPS_ADDR A:0x61e04d9c
y.create.l HWIO_APPS_SMMU_SSD_REG_872_APPS_ADDR A:0x61e04da0
y.create.l HWIO_APPS_SMMU_SSD_REG_873_APPS_ADDR A:0x61e04da4
y.create.l HWIO_APPS_SMMU_SSD_REG_874_APPS_ADDR A:0x61e04da8
y.create.l HWIO_APPS_SMMU_SSD_REG_875_APPS_ADDR A:0x61e04dac
y.create.l HWIO_APPS_SMMU_SSD_REG_876_APPS_ADDR A:0x61e04db0
y.create.l HWIO_APPS_SMMU_SSD_REG_877_APPS_ADDR A:0x61e04db4
y.create.l HWIO_APPS_SMMU_SSD_REG_878_APPS_ADDR A:0x61e04db8
y.create.l HWIO_APPS_SMMU_SSD_REG_879_APPS_ADDR A:0x61e04dbc
y.create.l HWIO_APPS_SMMU_SSD_REG_880_APPS_ADDR A:0x61e04dc0
y.create.l HWIO_APPS_SMMU_SSD_REG_881_APPS_ADDR A:0x61e04dc4
y.create.l HWIO_APPS_SMMU_SSD_REG_882_APPS_ADDR A:0x61e04dc8
y.create.l HWIO_APPS_SMMU_SSD_REG_883_APPS_ADDR A:0x61e04dcc
y.create.l HWIO_APPS_SMMU_SSD_REG_884_APPS_ADDR A:0x61e04dd0
y.create.l HWIO_APPS_SMMU_SSD_REG_885_APPS_ADDR A:0x61e04dd4
y.create.l HWIO_APPS_SMMU_SSD_REG_886_APPS_ADDR A:0x61e04dd8
y.create.l HWIO_APPS_SMMU_SSD_REG_887_APPS_ADDR A:0x61e04ddc
y.create.l HWIO_APPS_SMMU_SSD_REG_888_APPS_ADDR A:0x61e04de0
y.create.l HWIO_APPS_SMMU_SSD_REG_889_APPS_ADDR A:0x61e04de4
y.create.l HWIO_APPS_SMMU_SSD_REG_890_APPS_ADDR A:0x61e04de8
y.create.l HWIO_APPS_SMMU_SSD_REG_891_APPS_ADDR A:0x61e04dec
y.create.l HWIO_APPS_SMMU_SSD_REG_892_APPS_ADDR A:0x61e04df0
y.create.l HWIO_APPS_SMMU_SSD_REG_893_APPS_ADDR A:0x61e04df4
y.create.l HWIO_APPS_SMMU_SSD_REG_894_APPS_ADDR A:0x61e04df8
y.create.l HWIO_APPS_SMMU_SSD_REG_895_APPS_ADDR A:0x61e04dfc
y.create.l HWIO_APPS_SMMU_SSD_REG_896_APPS_ADDR A:0x61e04e00
y.create.l HWIO_APPS_SMMU_SSD_REG_897_APPS_ADDR A:0x61e04e04
y.create.l HWIO_APPS_SMMU_SSD_REG_898_APPS_ADDR A:0x61e04e08
y.create.l HWIO_APPS_SMMU_SSD_REG_899_APPS_ADDR A:0x61e04e0c
y.create.l HWIO_APPS_SMMU_SSD_REG_900_APPS_ADDR A:0x61e04e10
y.create.l HWIO_APPS_SMMU_SSD_REG_901_APPS_ADDR A:0x61e04e14
y.create.l HWIO_APPS_SMMU_SSD_REG_902_APPS_ADDR A:0x61e04e18
y.create.l HWIO_APPS_SMMU_SSD_REG_903_APPS_ADDR A:0x61e04e1c
y.create.l HWIO_APPS_SMMU_SSD_REG_904_APPS_ADDR A:0x61e04e20
y.create.l HWIO_APPS_SMMU_SSD_REG_905_APPS_ADDR A:0x61e04e24
y.create.l HWIO_APPS_SMMU_SSD_REG_906_APPS_ADDR A:0x61e04e28
y.create.l HWIO_APPS_SMMU_SSD_REG_907_APPS_ADDR A:0x61e04e2c
y.create.l HWIO_APPS_SMMU_SSD_REG_908_APPS_ADDR A:0x61e04e30
y.create.l HWIO_APPS_SMMU_SSD_REG_909_APPS_ADDR A:0x61e04e34
y.create.l HWIO_APPS_SMMU_SSD_REG_910_APPS_ADDR A:0x61e04e38
y.create.l HWIO_APPS_SMMU_SSD_REG_911_APPS_ADDR A:0x61e04e3c
y.create.l HWIO_APPS_SMMU_SSD_REG_912_APPS_ADDR A:0x61e04e40
y.create.l HWIO_APPS_SMMU_SSD_REG_913_APPS_ADDR A:0x61e04e44
y.create.l HWIO_APPS_SMMU_SSD_REG_914_APPS_ADDR A:0x61e04e48
y.create.l HWIO_APPS_SMMU_SSD_REG_915_APPS_ADDR A:0x61e04e4c
y.create.l HWIO_APPS_SMMU_SSD_REG_916_APPS_ADDR A:0x61e04e50
y.create.l HWIO_APPS_SMMU_SSD_REG_917_APPS_ADDR A:0x61e04e54
y.create.l HWIO_APPS_SMMU_SSD_REG_918_APPS_ADDR A:0x61e04e58
y.create.l HWIO_APPS_SMMU_SSD_REG_919_APPS_ADDR A:0x61e04e5c
y.create.l HWIO_APPS_SMMU_SSD_REG_920_APPS_ADDR A:0x61e04e60
y.create.l HWIO_APPS_SMMU_SSD_REG_921_APPS_ADDR A:0x61e04e64
y.create.l HWIO_APPS_SMMU_SSD_REG_922_APPS_ADDR A:0x61e04e68
y.create.l HWIO_APPS_SMMU_SSD_REG_923_APPS_ADDR A:0x61e04e6c
y.create.l HWIO_APPS_SMMU_SSD_REG_924_APPS_ADDR A:0x61e04e70
y.create.l HWIO_APPS_SMMU_SSD_REG_925_APPS_ADDR A:0x61e04e74
y.create.l HWIO_APPS_SMMU_SSD_REG_926_APPS_ADDR A:0x61e04e78
y.create.l HWIO_APPS_SMMU_SSD_REG_927_APPS_ADDR A:0x61e04e7c
y.create.l HWIO_APPS_SMMU_SSD_REG_928_APPS_ADDR A:0x61e04e80
y.create.l HWIO_APPS_SMMU_SSD_REG_929_APPS_ADDR A:0x61e04e84
y.create.l HWIO_APPS_SMMU_SSD_REG_930_APPS_ADDR A:0x61e04e88
y.create.l HWIO_APPS_SMMU_SSD_REG_931_APPS_ADDR A:0x61e04e8c
y.create.l HWIO_APPS_SMMU_SSD_REG_932_APPS_ADDR A:0x61e04e90
y.create.l HWIO_APPS_SMMU_SSD_REG_933_APPS_ADDR A:0x61e04e94
y.create.l HWIO_APPS_SMMU_SSD_REG_934_APPS_ADDR A:0x61e04e98
y.create.l HWIO_APPS_SMMU_SSD_REG_935_APPS_ADDR A:0x61e04e9c
y.create.l HWIO_APPS_SMMU_SSD_REG_936_APPS_ADDR A:0x61e04ea0
y.create.l HWIO_APPS_SMMU_SSD_REG_937_APPS_ADDR A:0x61e04ea4
y.create.l HWIO_APPS_SMMU_SSD_REG_938_APPS_ADDR A:0x61e04ea8
y.create.l HWIO_APPS_SMMU_SSD_REG_939_APPS_ADDR A:0x61e04eac
y.create.l HWIO_APPS_SMMU_SSD_REG_940_APPS_ADDR A:0x61e04eb0
y.create.l HWIO_APPS_SMMU_SSD_REG_941_APPS_ADDR A:0x61e04eb4
y.create.l HWIO_APPS_SMMU_SSD_REG_942_APPS_ADDR A:0x61e04eb8
y.create.l HWIO_APPS_SMMU_SSD_REG_943_APPS_ADDR A:0x61e04ebc
y.create.l HWIO_APPS_SMMU_SSD_REG_944_APPS_ADDR A:0x61e04ec0
y.create.l HWIO_APPS_SMMU_SSD_REG_945_APPS_ADDR A:0x61e04ec4
y.create.l HWIO_APPS_SMMU_SSD_REG_946_APPS_ADDR A:0x61e04ec8
y.create.l HWIO_APPS_SMMU_SSD_REG_947_APPS_ADDR A:0x61e04ecc
y.create.l HWIO_APPS_SMMU_SSD_REG_948_APPS_ADDR A:0x61e04ed0
y.create.l HWIO_APPS_SMMU_SSD_REG_949_APPS_ADDR A:0x61e04ed4
y.create.l HWIO_APPS_SMMU_SSD_REG_950_APPS_ADDR A:0x61e04ed8
y.create.l HWIO_APPS_SMMU_SSD_REG_951_APPS_ADDR A:0x61e04edc
y.create.l HWIO_APPS_SMMU_SSD_REG_952_APPS_ADDR A:0x61e04ee0
y.create.l HWIO_APPS_SMMU_SSD_REG_953_APPS_ADDR A:0x61e04ee4
y.create.l HWIO_APPS_SMMU_SSD_REG_954_APPS_ADDR A:0x61e04ee8
y.create.l HWIO_APPS_SMMU_SSD_REG_955_APPS_ADDR A:0x61e04eec
y.create.l HWIO_APPS_SMMU_SSD_REG_956_APPS_ADDR A:0x61e04ef0
y.create.l HWIO_APPS_SMMU_SSD_REG_957_APPS_ADDR A:0x61e04ef4
y.create.l HWIO_APPS_SMMU_SSD_REG_958_APPS_ADDR A:0x61e04ef8
y.create.l HWIO_APPS_SMMU_SSD_REG_959_APPS_ADDR A:0x61e04efc
y.create.l HWIO_APPS_SMMU_SSD_REG_960_APPS_ADDR A:0x61e04f00
y.create.l HWIO_APPS_SMMU_SSD_REG_961_APPS_ADDR A:0x61e04f04
y.create.l HWIO_APPS_SMMU_SSD_REG_962_APPS_ADDR A:0x61e04f08
y.create.l HWIO_APPS_SMMU_SSD_REG_963_APPS_ADDR A:0x61e04f0c
y.create.l HWIO_APPS_SMMU_SSD_REG_964_APPS_ADDR A:0x61e04f10
y.create.l HWIO_APPS_SMMU_SSD_REG_965_APPS_ADDR A:0x61e04f14
y.create.l HWIO_APPS_SMMU_SSD_REG_966_APPS_ADDR A:0x61e04f18
y.create.l HWIO_APPS_SMMU_SSD_REG_967_APPS_ADDR A:0x61e04f1c
y.create.l HWIO_APPS_SMMU_SSD_REG_968_APPS_ADDR A:0x61e04f20
y.create.l HWIO_APPS_SMMU_SSD_REG_969_APPS_ADDR A:0x61e04f24
y.create.l HWIO_APPS_SMMU_SSD_REG_970_APPS_ADDR A:0x61e04f28
y.create.l HWIO_APPS_SMMU_SSD_REG_971_APPS_ADDR A:0x61e04f2c
y.create.l HWIO_APPS_SMMU_SSD_REG_972_APPS_ADDR A:0x61e04f30
y.create.l HWIO_APPS_SMMU_SSD_REG_973_APPS_ADDR A:0x61e04f34
y.create.l HWIO_APPS_SMMU_SSD_REG_974_APPS_ADDR A:0x61e04f38
y.create.l HWIO_APPS_SMMU_SSD_REG_975_APPS_ADDR A:0x61e04f3c
y.create.l HWIO_APPS_SMMU_SSD_REG_976_APPS_ADDR A:0x61e04f40
y.create.l HWIO_APPS_SMMU_SSD_REG_977_APPS_ADDR A:0x61e04f44
y.create.l HWIO_APPS_SMMU_SSD_REG_978_APPS_ADDR A:0x61e04f48
y.create.l HWIO_APPS_SMMU_SSD_REG_979_APPS_ADDR A:0x61e04f4c
y.create.l HWIO_APPS_SMMU_SSD_REG_980_APPS_ADDR A:0x61e04f50
y.create.l HWIO_APPS_SMMU_SSD_REG_981_APPS_ADDR A:0x61e04f54
y.create.l HWIO_APPS_SMMU_SSD_REG_982_APPS_ADDR A:0x61e04f58
y.create.l HWIO_APPS_SMMU_SSD_REG_983_APPS_ADDR A:0x61e04f5c
y.create.l HWIO_APPS_SMMU_SSD_REG_984_APPS_ADDR A:0x61e04f60
y.create.l HWIO_APPS_SMMU_SSD_REG_985_APPS_ADDR A:0x61e04f64
y.create.l HWIO_APPS_SMMU_SSD_REG_986_APPS_ADDR A:0x61e04f68
y.create.l HWIO_APPS_SMMU_SSD_REG_987_APPS_ADDR A:0x61e04f6c
y.create.l HWIO_APPS_SMMU_SSD_REG_988_APPS_ADDR A:0x61e04f70
y.create.l HWIO_APPS_SMMU_SSD_REG_989_APPS_ADDR A:0x61e04f74
y.create.l HWIO_APPS_SMMU_SSD_REG_990_APPS_ADDR A:0x61e04f78
y.create.l HWIO_APPS_SMMU_SSD_REG_991_APPS_ADDR A:0x61e04f7c
y.create.l HWIO_APPS_SMMU_SSD_REG_992_APPS_ADDR A:0x61e04f80
y.create.l HWIO_APPS_SMMU_SSD_REG_993_APPS_ADDR A:0x61e04f84
y.create.l HWIO_APPS_SMMU_SSD_REG_994_APPS_ADDR A:0x61e04f88
y.create.l HWIO_APPS_SMMU_SSD_REG_995_APPS_ADDR A:0x61e04f8c
y.create.l HWIO_APPS_SMMU_SSD_REG_996_APPS_ADDR A:0x61e04f90
y.create.l HWIO_APPS_SMMU_SSD_REG_997_APPS_ADDR A:0x61e04f94
y.create.l HWIO_APPS_SMMU_SSD_REG_998_APPS_ADDR A:0x61e04f98
y.create.l HWIO_APPS_SMMU_SSD_REG_999_APPS_ADDR A:0x61e04f9c
y.create.l HWIO_APPS_SMMU_SSD_REG_1000_APPS_ADDR A:0x61e04fa0
y.create.l HWIO_APPS_SMMU_SSD_REG_1001_APPS_ADDR A:0x61e04fa4
y.create.l HWIO_APPS_SMMU_SSD_REG_1002_APPS_ADDR A:0x61e04fa8
y.create.l HWIO_APPS_SMMU_SSD_REG_1003_APPS_ADDR A:0x61e04fac
y.create.l HWIO_APPS_SMMU_SSD_REG_1004_APPS_ADDR A:0x61e04fb0
y.create.l HWIO_APPS_SMMU_SSD_REG_1005_APPS_ADDR A:0x61e04fb4
y.create.l HWIO_APPS_SMMU_SSD_REG_1006_APPS_ADDR A:0x61e04fb8
y.create.l HWIO_APPS_SMMU_SSD_REG_1007_APPS_ADDR A:0x61e04fbc
y.create.l HWIO_APPS_SMMU_SSD_REG_1008_APPS_ADDR A:0x61e04fc0
y.create.l HWIO_APPS_SMMU_SSD_REG_1009_APPS_ADDR A:0x61e04fc4
y.create.l HWIO_APPS_SMMU_SSD_REG_1010_APPS_ADDR A:0x61e04fc8
y.create.l HWIO_APPS_SMMU_SSD_REG_1011_APPS_ADDR A:0x61e04fcc
y.create.l HWIO_APPS_SMMU_SSD_REG_1012_APPS_ADDR A:0x61e04fd0
y.create.l HWIO_APPS_SMMU_SSD_REG_1013_APPS_ADDR A:0x61e04fd4
y.create.l HWIO_APPS_SMMU_SSD_REG_1014_APPS_ADDR A:0x61e04fd8
y.create.l HWIO_APPS_SMMU_SSD_REG_1015_APPS_ADDR A:0x61e04fdc
y.create.l HWIO_APPS_SMMU_SSD_REG_1016_APPS_ADDR A:0x61e04fe0
y.create.l HWIO_APPS_SMMU_SSD_REG_1017_APPS_ADDR A:0x61e04fe4
y.create.l HWIO_APPS_SMMU_SSD_REG_1018_APPS_ADDR A:0x61e04fe8
y.create.l HWIO_APPS_SMMU_SSD_REG_1019_APPS_ADDR A:0x61e04fec
y.create.l HWIO_APPS_SMMU_SSD_REG_1020_APPS_ADDR A:0x61e04ff0
y.create.l HWIO_APPS_SMMU_SSD_REG_1021_APPS_ADDR A:0x61e04ff4
y.create.l HWIO_APPS_SMMU_SSD_REG_1022_APPS_ADDR A:0x61e04ff8
y.create.l HWIO_APPS_SMMU_SSD_REG_1023_APPS_ADDR A:0x61e04ffc
y.create.l HWIO_APPS_SMMU_CB0_SCTLR_APPS_ADDR A:0x61e10000
y.create.l HWIO_APPS_SMMU_CB1_SCTLR_APPS_ADDR A:0x61e11000
y.create.l HWIO_APPS_SMMU_CB2_SCTLR_APPS_ADDR A:0x61e12000
y.create.l HWIO_APPS_SMMU_CB3_SCTLR_APPS_ADDR A:0x61e13000
y.create.l HWIO_APPS_SMMU_CB4_SCTLR_APPS_ADDR A:0x61e14000
y.create.l HWIO_APPS_SMMU_CB5_SCTLR_APPS_ADDR A:0x61e15000
y.create.l HWIO_APPS_SMMU_CB6_SCTLR_APPS_ADDR A:0x61e16000
y.create.l HWIO_APPS_SMMU_CB7_SCTLR_APPS_ADDR A:0x61e17000
y.create.l HWIO_APPS_SMMU_CB8_SCTLR_APPS_ADDR A:0x61e18000
y.create.l HWIO_APPS_SMMU_CB9_SCTLR_APPS_ADDR A:0x61e19000
y.create.l HWIO_APPS_SMMU_CB10_SCTLR_APPS_ADDR A:0x61e1a000
y.create.l HWIO_APPS_SMMU_CB11_SCTLR_APPS_ADDR A:0x61e1b000
y.create.l HWIO_APPS_SMMU_CB12_SCTLR_APPS_ADDR A:0x61e1c000
y.create.l HWIO_APPS_SMMU_CB13_SCTLR_APPS_ADDR A:0x61e1d000
y.create.l HWIO_APPS_SMMU_CB14_SCTLR_APPS_ADDR A:0x61e1e000
y.create.l HWIO_APPS_SMMU_CB15_SCTLR_APPS_ADDR A:0x61e1f000
y.create.l HWIO_APPS_SMMU_CB0_ACTLR_APPS_ADDR A:0x61e10004
y.create.l HWIO_APPS_SMMU_CB1_ACTLR_APPS_ADDR A:0x61e11004
y.create.l HWIO_APPS_SMMU_CB2_ACTLR_APPS_ADDR A:0x61e12004
y.create.l HWIO_APPS_SMMU_CB3_ACTLR_APPS_ADDR A:0x61e13004
y.create.l HWIO_APPS_SMMU_CB4_ACTLR_APPS_ADDR A:0x61e14004
y.create.l HWIO_APPS_SMMU_CB5_ACTLR_APPS_ADDR A:0x61e15004
y.create.l HWIO_APPS_SMMU_CB6_ACTLR_APPS_ADDR A:0x61e16004
y.create.l HWIO_APPS_SMMU_CB7_ACTLR_APPS_ADDR A:0x61e17004
y.create.l HWIO_APPS_SMMU_CB8_ACTLR_APPS_ADDR A:0x61e18004
y.create.l HWIO_APPS_SMMU_CB9_ACTLR_APPS_ADDR A:0x61e19004
y.create.l HWIO_APPS_SMMU_CB10_ACTLR_APPS_ADDR A:0x61e1a004
y.create.l HWIO_APPS_SMMU_CB11_ACTLR_APPS_ADDR A:0x61e1b004
y.create.l HWIO_APPS_SMMU_CB12_ACTLR_APPS_ADDR A:0x61e1c004
y.create.l HWIO_APPS_SMMU_CB13_ACTLR_APPS_ADDR A:0x61e1d004
y.create.l HWIO_APPS_SMMU_CB14_ACTLR_APPS_ADDR A:0x61e1e004
y.create.l HWIO_APPS_SMMU_CB15_ACTLR_APPS_ADDR A:0x61e1f004
y.create.l HWIO_APPS_SMMU_CB0_RESUME_APPS_ADDR A:0x61e10008
y.create.l HWIO_APPS_SMMU_CB1_RESUME_APPS_ADDR A:0x61e11008
y.create.l HWIO_APPS_SMMU_CB2_RESUME_APPS_ADDR A:0x61e12008
y.create.l HWIO_APPS_SMMU_CB3_RESUME_APPS_ADDR A:0x61e13008
y.create.l HWIO_APPS_SMMU_CB4_RESUME_APPS_ADDR A:0x61e14008
y.create.l HWIO_APPS_SMMU_CB5_RESUME_APPS_ADDR A:0x61e15008
y.create.l HWIO_APPS_SMMU_CB6_RESUME_APPS_ADDR A:0x61e16008
y.create.l HWIO_APPS_SMMU_CB7_RESUME_APPS_ADDR A:0x61e17008
y.create.l HWIO_APPS_SMMU_CB8_RESUME_APPS_ADDR A:0x61e18008
y.create.l HWIO_APPS_SMMU_CB9_RESUME_APPS_ADDR A:0x61e19008
y.create.l HWIO_APPS_SMMU_CB10_RESUME_APPS_ADDR A:0x61e1a008
y.create.l HWIO_APPS_SMMU_CB11_RESUME_APPS_ADDR A:0x61e1b008
y.create.l HWIO_APPS_SMMU_CB12_RESUME_APPS_ADDR A:0x61e1c008
y.create.l HWIO_APPS_SMMU_CB13_RESUME_APPS_ADDR A:0x61e1d008
y.create.l HWIO_APPS_SMMU_CB14_RESUME_APPS_ADDR A:0x61e1e008
y.create.l HWIO_APPS_SMMU_CB15_RESUME_APPS_ADDR A:0x61e1f008
y.create.l HWIO_APPS_SMMU_CB0_TCR2_APPS_ADDR A:0x61e10010
y.create.l HWIO_APPS_SMMU_CB1_TCR2_APPS_ADDR A:0x61e11010
y.create.l HWIO_APPS_SMMU_CB2_TCR2_APPS_ADDR A:0x61e12010
y.create.l HWIO_APPS_SMMU_CB3_TCR2_APPS_ADDR A:0x61e13010
y.create.l HWIO_APPS_SMMU_CB4_TCR2_APPS_ADDR A:0x61e14010
y.create.l HWIO_APPS_SMMU_CB5_TCR2_APPS_ADDR A:0x61e15010
y.create.l HWIO_APPS_SMMU_CB6_TCR2_APPS_ADDR A:0x61e16010
y.create.l HWIO_APPS_SMMU_CB7_TCR2_APPS_ADDR A:0x61e17010
y.create.l HWIO_APPS_SMMU_CB8_TCR2_APPS_ADDR A:0x61e18010
y.create.l HWIO_APPS_SMMU_CB9_TCR2_APPS_ADDR A:0x61e19010
y.create.l HWIO_APPS_SMMU_CB10_TCR2_APPS_ADDR A:0x61e1a010
y.create.l HWIO_APPS_SMMU_CB11_TCR2_APPS_ADDR A:0x61e1b010
y.create.l HWIO_APPS_SMMU_CB12_TCR2_APPS_ADDR A:0x61e1c010
y.create.l HWIO_APPS_SMMU_CB13_TCR2_APPS_ADDR A:0x61e1d010
y.create.l HWIO_APPS_SMMU_CB14_TCR2_APPS_ADDR A:0x61e1e010
y.create.l HWIO_APPS_SMMU_CB15_TCR2_APPS_ADDR A:0x61e1f010
y.create.l HWIO_APPS_SMMU_CB0_TTBR0_LOW_APPS_ADDR A:0x61e10020
y.create.l HWIO_APPS_SMMU_CB1_TTBR0_LOW_APPS_ADDR A:0x61e11020
y.create.l HWIO_APPS_SMMU_CB2_TTBR0_LOW_APPS_ADDR A:0x61e12020
y.create.l HWIO_APPS_SMMU_CB3_TTBR0_LOW_APPS_ADDR A:0x61e13020
y.create.l HWIO_APPS_SMMU_CB4_TTBR0_LOW_APPS_ADDR A:0x61e14020
y.create.l HWIO_APPS_SMMU_CB5_TTBR0_LOW_APPS_ADDR A:0x61e15020
y.create.l HWIO_APPS_SMMU_CB6_TTBR0_LOW_APPS_ADDR A:0x61e16020
y.create.l HWIO_APPS_SMMU_CB7_TTBR0_LOW_APPS_ADDR A:0x61e17020
y.create.l HWIO_APPS_SMMU_CB8_TTBR0_LOW_APPS_ADDR A:0x61e18020
y.create.l HWIO_APPS_SMMU_CB9_TTBR0_LOW_APPS_ADDR A:0x61e19020
y.create.l HWIO_APPS_SMMU_CB10_TTBR0_LOW_APPS_ADDR A:0x61e1a020
y.create.l HWIO_APPS_SMMU_CB11_TTBR0_LOW_APPS_ADDR A:0x61e1b020
y.create.l HWIO_APPS_SMMU_CB12_TTBR0_LOW_APPS_ADDR A:0x61e1c020
y.create.l HWIO_APPS_SMMU_CB13_TTBR0_LOW_APPS_ADDR A:0x61e1d020
y.create.l HWIO_APPS_SMMU_CB14_TTBR0_LOW_APPS_ADDR A:0x61e1e020
y.create.l HWIO_APPS_SMMU_CB15_TTBR0_LOW_APPS_ADDR A:0x61e1f020
y.create.l HWIO_APPS_SMMU_CB0_TTBR0_HIGH_APPS_ADDR A:0x61e10024
y.create.l HWIO_APPS_SMMU_CB1_TTBR0_HIGH_APPS_ADDR A:0x61e11024
y.create.l HWIO_APPS_SMMU_CB2_TTBR0_HIGH_APPS_ADDR A:0x61e12024
y.create.l HWIO_APPS_SMMU_CB3_TTBR0_HIGH_APPS_ADDR A:0x61e13024
y.create.l HWIO_APPS_SMMU_CB4_TTBR0_HIGH_APPS_ADDR A:0x61e14024
y.create.l HWIO_APPS_SMMU_CB5_TTBR0_HIGH_APPS_ADDR A:0x61e15024
y.create.l HWIO_APPS_SMMU_CB6_TTBR0_HIGH_APPS_ADDR A:0x61e16024
y.create.l HWIO_APPS_SMMU_CB7_TTBR0_HIGH_APPS_ADDR A:0x61e17024
y.create.l HWIO_APPS_SMMU_CB8_TTBR0_HIGH_APPS_ADDR A:0x61e18024
y.create.l HWIO_APPS_SMMU_CB9_TTBR0_HIGH_APPS_ADDR A:0x61e19024
y.create.l HWIO_APPS_SMMU_CB10_TTBR0_HIGH_APPS_ADDR A:0x61e1a024
y.create.l HWIO_APPS_SMMU_CB11_TTBR0_HIGH_APPS_ADDR A:0x61e1b024
y.create.l HWIO_APPS_SMMU_CB12_TTBR0_HIGH_APPS_ADDR A:0x61e1c024
y.create.l HWIO_APPS_SMMU_CB13_TTBR0_HIGH_APPS_ADDR A:0x61e1d024
y.create.l HWIO_APPS_SMMU_CB14_TTBR0_HIGH_APPS_ADDR A:0x61e1e024
y.create.l HWIO_APPS_SMMU_CB15_TTBR0_HIGH_APPS_ADDR A:0x61e1f024
y.create.l HWIO_APPS_SMMU_CB0_TTBR1_LOW_APPS_ADDR A:0x61e10028
y.create.l HWIO_APPS_SMMU_CB1_TTBR1_LOW_APPS_ADDR A:0x61e11028
y.create.l HWIO_APPS_SMMU_CB2_TTBR1_LOW_APPS_ADDR A:0x61e12028
y.create.l HWIO_APPS_SMMU_CB3_TTBR1_LOW_APPS_ADDR A:0x61e13028
y.create.l HWIO_APPS_SMMU_CB4_TTBR1_LOW_APPS_ADDR A:0x61e14028
y.create.l HWIO_APPS_SMMU_CB5_TTBR1_LOW_APPS_ADDR A:0x61e15028
y.create.l HWIO_APPS_SMMU_CB6_TTBR1_LOW_APPS_ADDR A:0x61e16028
y.create.l HWIO_APPS_SMMU_CB7_TTBR1_LOW_APPS_ADDR A:0x61e17028
y.create.l HWIO_APPS_SMMU_CB8_TTBR1_LOW_APPS_ADDR A:0x61e18028
y.create.l HWIO_APPS_SMMU_CB9_TTBR1_LOW_APPS_ADDR A:0x61e19028
y.create.l HWIO_APPS_SMMU_CB10_TTBR1_LOW_APPS_ADDR A:0x61e1a028
y.create.l HWIO_APPS_SMMU_CB11_TTBR1_LOW_APPS_ADDR A:0x61e1b028
y.create.l HWIO_APPS_SMMU_CB12_TTBR1_LOW_APPS_ADDR A:0x61e1c028
y.create.l HWIO_APPS_SMMU_CB13_TTBR1_LOW_APPS_ADDR A:0x61e1d028
y.create.l HWIO_APPS_SMMU_CB14_TTBR1_LOW_APPS_ADDR A:0x61e1e028
y.create.l HWIO_APPS_SMMU_CB15_TTBR1_LOW_APPS_ADDR A:0x61e1f028
y.create.l HWIO_APPS_SMMU_CB0_TTBR1_HIGH_APPS_ADDR A:0x61e1002c
y.create.l HWIO_APPS_SMMU_CB1_TTBR1_HIGH_APPS_ADDR A:0x61e1102c
y.create.l HWIO_APPS_SMMU_CB2_TTBR1_HIGH_APPS_ADDR A:0x61e1202c
y.create.l HWIO_APPS_SMMU_CB3_TTBR1_HIGH_APPS_ADDR A:0x61e1302c
y.create.l HWIO_APPS_SMMU_CB4_TTBR1_HIGH_APPS_ADDR A:0x61e1402c
y.create.l HWIO_APPS_SMMU_CB5_TTBR1_HIGH_APPS_ADDR A:0x61e1502c
y.create.l HWIO_APPS_SMMU_CB6_TTBR1_HIGH_APPS_ADDR A:0x61e1602c
y.create.l HWIO_APPS_SMMU_CB7_TTBR1_HIGH_APPS_ADDR A:0x61e1702c
y.create.l HWIO_APPS_SMMU_CB8_TTBR1_HIGH_APPS_ADDR A:0x61e1802c
y.create.l HWIO_APPS_SMMU_CB9_TTBR1_HIGH_APPS_ADDR A:0x61e1902c
y.create.l HWIO_APPS_SMMU_CB10_TTBR1_HIGH_APPS_ADDR A:0x61e1a02c
y.create.l HWIO_APPS_SMMU_CB11_TTBR1_HIGH_APPS_ADDR A:0x61e1b02c
y.create.l HWIO_APPS_SMMU_CB12_TTBR1_HIGH_APPS_ADDR A:0x61e1c02c
y.create.l HWIO_APPS_SMMU_CB13_TTBR1_HIGH_APPS_ADDR A:0x61e1d02c
y.create.l HWIO_APPS_SMMU_CB14_TTBR1_HIGH_APPS_ADDR A:0x61e1e02c
y.create.l HWIO_APPS_SMMU_CB15_TTBR1_HIGH_APPS_ADDR A:0x61e1f02c
y.create.l HWIO_APPS_SMMU_CB0_TCR_LPAE_APPS_ADDR A:0x61e10030
y.create.l HWIO_APPS_SMMU_CB1_TCR_LPAE_APPS_ADDR A:0x61e11030
y.create.l HWIO_APPS_SMMU_CB2_TCR_LPAE_APPS_ADDR A:0x61e12030
y.create.l HWIO_APPS_SMMU_CB3_TCR_LPAE_APPS_ADDR A:0x61e13030
y.create.l HWIO_APPS_SMMU_CB4_TCR_LPAE_APPS_ADDR A:0x61e14030
y.create.l HWIO_APPS_SMMU_CB5_TCR_LPAE_APPS_ADDR A:0x61e15030
y.create.l HWIO_APPS_SMMU_CB6_TCR_LPAE_APPS_ADDR A:0x61e16030
y.create.l HWIO_APPS_SMMU_CB7_TCR_LPAE_APPS_ADDR A:0x61e17030
y.create.l HWIO_APPS_SMMU_CB8_TCR_LPAE_APPS_ADDR A:0x61e18030
y.create.l HWIO_APPS_SMMU_CB9_TCR_LPAE_APPS_ADDR A:0x61e19030
y.create.l HWIO_APPS_SMMU_CB10_TCR_LPAE_APPS_ADDR A:0x61e1a030
y.create.l HWIO_APPS_SMMU_CB11_TCR_LPAE_APPS_ADDR A:0x61e1b030
y.create.l HWIO_APPS_SMMU_CB12_TCR_LPAE_APPS_ADDR A:0x61e1c030
y.create.l HWIO_APPS_SMMU_CB13_TCR_LPAE_APPS_ADDR A:0x61e1d030
y.create.l HWIO_APPS_SMMU_CB14_TCR_LPAE_APPS_ADDR A:0x61e1e030
y.create.l HWIO_APPS_SMMU_CB15_TCR_LPAE_APPS_ADDR A:0x61e1f030
y.create.l HWIO_APPS_SMMU_CB0_CONTEXTIDR_APPS_ADDR A:0x61e10034
y.create.l HWIO_APPS_SMMU_CB1_CONTEXTIDR_APPS_ADDR A:0x61e11034
y.create.l HWIO_APPS_SMMU_CB2_CONTEXTIDR_APPS_ADDR A:0x61e12034
y.create.l HWIO_APPS_SMMU_CB3_CONTEXTIDR_APPS_ADDR A:0x61e13034
y.create.l HWIO_APPS_SMMU_CB4_CONTEXTIDR_APPS_ADDR A:0x61e14034
y.create.l HWIO_APPS_SMMU_CB5_CONTEXTIDR_APPS_ADDR A:0x61e15034
y.create.l HWIO_APPS_SMMU_CB6_CONTEXTIDR_APPS_ADDR A:0x61e16034
y.create.l HWIO_APPS_SMMU_CB7_CONTEXTIDR_APPS_ADDR A:0x61e17034
y.create.l HWIO_APPS_SMMU_CB8_CONTEXTIDR_APPS_ADDR A:0x61e18034
y.create.l HWIO_APPS_SMMU_CB9_CONTEXTIDR_APPS_ADDR A:0x61e19034
y.create.l HWIO_APPS_SMMU_CB10_CONTEXTIDR_APPS_ADDR A:0x61e1a034
y.create.l HWIO_APPS_SMMU_CB11_CONTEXTIDR_APPS_ADDR A:0x61e1b034
y.create.l HWIO_APPS_SMMU_CB12_CONTEXTIDR_APPS_ADDR A:0x61e1c034
y.create.l HWIO_APPS_SMMU_CB13_CONTEXTIDR_APPS_ADDR A:0x61e1d034
y.create.l HWIO_APPS_SMMU_CB14_CONTEXTIDR_APPS_ADDR A:0x61e1e034
y.create.l HWIO_APPS_SMMU_CB15_CONTEXTIDR_APPS_ADDR A:0x61e1f034
y.create.l HWIO_APPS_SMMU_CB0_PRRR_MAIR0_APPS_ADDR A:0x61e10038
y.create.l HWIO_APPS_SMMU_CB1_PRRR_MAIR0_APPS_ADDR A:0x61e11038
y.create.l HWIO_APPS_SMMU_CB2_PRRR_MAIR0_APPS_ADDR A:0x61e12038
y.create.l HWIO_APPS_SMMU_CB3_PRRR_MAIR0_APPS_ADDR A:0x61e13038
y.create.l HWIO_APPS_SMMU_CB4_PRRR_MAIR0_APPS_ADDR A:0x61e14038
y.create.l HWIO_APPS_SMMU_CB5_PRRR_MAIR0_APPS_ADDR A:0x61e15038
y.create.l HWIO_APPS_SMMU_CB6_PRRR_MAIR0_APPS_ADDR A:0x61e16038
y.create.l HWIO_APPS_SMMU_CB7_PRRR_MAIR0_APPS_ADDR A:0x61e17038
y.create.l HWIO_APPS_SMMU_CB8_PRRR_MAIR0_APPS_ADDR A:0x61e18038
y.create.l HWIO_APPS_SMMU_CB9_PRRR_MAIR0_APPS_ADDR A:0x61e19038
y.create.l HWIO_APPS_SMMU_CB10_PRRR_MAIR0_APPS_ADDR A:0x61e1a038
y.create.l HWIO_APPS_SMMU_CB11_PRRR_MAIR0_APPS_ADDR A:0x61e1b038
y.create.l HWIO_APPS_SMMU_CB12_PRRR_MAIR0_APPS_ADDR A:0x61e1c038
y.create.l HWIO_APPS_SMMU_CB13_PRRR_MAIR0_APPS_ADDR A:0x61e1d038
y.create.l HWIO_APPS_SMMU_CB14_PRRR_MAIR0_APPS_ADDR A:0x61e1e038
y.create.l HWIO_APPS_SMMU_CB15_PRRR_MAIR0_APPS_ADDR A:0x61e1f038
y.create.l HWIO_APPS_SMMU_CB0_NMRR_MAIR1_APPS_ADDR A:0x61e1003c
y.create.l HWIO_APPS_SMMU_CB1_NMRR_MAIR1_APPS_ADDR A:0x61e1103c
y.create.l HWIO_APPS_SMMU_CB2_NMRR_MAIR1_APPS_ADDR A:0x61e1203c
y.create.l HWIO_APPS_SMMU_CB3_NMRR_MAIR1_APPS_ADDR A:0x61e1303c
y.create.l HWIO_APPS_SMMU_CB4_NMRR_MAIR1_APPS_ADDR A:0x61e1403c
y.create.l HWIO_APPS_SMMU_CB5_NMRR_MAIR1_APPS_ADDR A:0x61e1503c
y.create.l HWIO_APPS_SMMU_CB6_NMRR_MAIR1_APPS_ADDR A:0x61e1603c
y.create.l HWIO_APPS_SMMU_CB7_NMRR_MAIR1_APPS_ADDR A:0x61e1703c
y.create.l HWIO_APPS_SMMU_CB8_NMRR_MAIR1_APPS_ADDR A:0x61e1803c
y.create.l HWIO_APPS_SMMU_CB9_NMRR_MAIR1_APPS_ADDR A:0x61e1903c
y.create.l HWIO_APPS_SMMU_CB10_NMRR_MAIR1_APPS_ADDR A:0x61e1a03c
y.create.l HWIO_APPS_SMMU_CB11_NMRR_MAIR1_APPS_ADDR A:0x61e1b03c
y.create.l HWIO_APPS_SMMU_CB12_NMRR_MAIR1_APPS_ADDR A:0x61e1c03c
y.create.l HWIO_APPS_SMMU_CB13_NMRR_MAIR1_APPS_ADDR A:0x61e1d03c
y.create.l HWIO_APPS_SMMU_CB14_NMRR_MAIR1_APPS_ADDR A:0x61e1e03c
y.create.l HWIO_APPS_SMMU_CB15_NMRR_MAIR1_APPS_ADDR A:0x61e1f03c
y.create.l HWIO_APPS_SMMU_CB0_FSR_APPS_ADDR A:0x61e10058
y.create.l HWIO_APPS_SMMU_CB1_FSR_APPS_ADDR A:0x61e11058
y.create.l HWIO_APPS_SMMU_CB2_FSR_APPS_ADDR A:0x61e12058
y.create.l HWIO_APPS_SMMU_CB3_FSR_APPS_ADDR A:0x61e13058
y.create.l HWIO_APPS_SMMU_CB4_FSR_APPS_ADDR A:0x61e14058
y.create.l HWIO_APPS_SMMU_CB5_FSR_APPS_ADDR A:0x61e15058
y.create.l HWIO_APPS_SMMU_CB6_FSR_APPS_ADDR A:0x61e16058
y.create.l HWIO_APPS_SMMU_CB7_FSR_APPS_ADDR A:0x61e17058
y.create.l HWIO_APPS_SMMU_CB8_FSR_APPS_ADDR A:0x61e18058
y.create.l HWIO_APPS_SMMU_CB9_FSR_APPS_ADDR A:0x61e19058
y.create.l HWIO_APPS_SMMU_CB10_FSR_APPS_ADDR A:0x61e1a058
y.create.l HWIO_APPS_SMMU_CB11_FSR_APPS_ADDR A:0x61e1b058
y.create.l HWIO_APPS_SMMU_CB12_FSR_APPS_ADDR A:0x61e1c058
y.create.l HWIO_APPS_SMMU_CB13_FSR_APPS_ADDR A:0x61e1d058
y.create.l HWIO_APPS_SMMU_CB14_FSR_APPS_ADDR A:0x61e1e058
y.create.l HWIO_APPS_SMMU_CB15_FSR_APPS_ADDR A:0x61e1f058
y.create.l HWIO_APPS_SMMU_CB0_FSRRESTORE_APPS_ADDR A:0x61e1005c
y.create.l HWIO_APPS_SMMU_CB1_FSRRESTORE_APPS_ADDR A:0x61e1105c
y.create.l HWIO_APPS_SMMU_CB2_FSRRESTORE_APPS_ADDR A:0x61e1205c
y.create.l HWIO_APPS_SMMU_CB3_FSRRESTORE_APPS_ADDR A:0x61e1305c
y.create.l HWIO_APPS_SMMU_CB4_FSRRESTORE_APPS_ADDR A:0x61e1405c
y.create.l HWIO_APPS_SMMU_CB5_FSRRESTORE_APPS_ADDR A:0x61e1505c
y.create.l HWIO_APPS_SMMU_CB6_FSRRESTORE_APPS_ADDR A:0x61e1605c
y.create.l HWIO_APPS_SMMU_CB7_FSRRESTORE_APPS_ADDR A:0x61e1705c
y.create.l HWIO_APPS_SMMU_CB8_FSRRESTORE_APPS_ADDR A:0x61e1805c
y.create.l HWIO_APPS_SMMU_CB9_FSRRESTORE_APPS_ADDR A:0x61e1905c
y.create.l HWIO_APPS_SMMU_CB10_FSRRESTORE_APPS_ADDR A:0x61e1a05c
y.create.l HWIO_APPS_SMMU_CB11_FSRRESTORE_APPS_ADDR A:0x61e1b05c
y.create.l HWIO_APPS_SMMU_CB12_FSRRESTORE_APPS_ADDR A:0x61e1c05c
y.create.l HWIO_APPS_SMMU_CB13_FSRRESTORE_APPS_ADDR A:0x61e1d05c
y.create.l HWIO_APPS_SMMU_CB14_FSRRESTORE_APPS_ADDR A:0x61e1e05c
y.create.l HWIO_APPS_SMMU_CB15_FSRRESTORE_APPS_ADDR A:0x61e1f05c
y.create.l HWIO_APPS_SMMU_CB0_FAR_LOW_APPS_ADDR A:0x61e10060
y.create.l HWIO_APPS_SMMU_CB1_FAR_LOW_APPS_ADDR A:0x61e11060
y.create.l HWIO_APPS_SMMU_CB2_FAR_LOW_APPS_ADDR A:0x61e12060
y.create.l HWIO_APPS_SMMU_CB3_FAR_LOW_APPS_ADDR A:0x61e13060
y.create.l HWIO_APPS_SMMU_CB4_FAR_LOW_APPS_ADDR A:0x61e14060
y.create.l HWIO_APPS_SMMU_CB5_FAR_LOW_APPS_ADDR A:0x61e15060
y.create.l HWIO_APPS_SMMU_CB6_FAR_LOW_APPS_ADDR A:0x61e16060
y.create.l HWIO_APPS_SMMU_CB7_FAR_LOW_APPS_ADDR A:0x61e17060
y.create.l HWIO_APPS_SMMU_CB8_FAR_LOW_APPS_ADDR A:0x61e18060
y.create.l HWIO_APPS_SMMU_CB9_FAR_LOW_APPS_ADDR A:0x61e19060
y.create.l HWIO_APPS_SMMU_CB10_FAR_LOW_APPS_ADDR A:0x61e1a060
y.create.l HWIO_APPS_SMMU_CB11_FAR_LOW_APPS_ADDR A:0x61e1b060
y.create.l HWIO_APPS_SMMU_CB12_FAR_LOW_APPS_ADDR A:0x61e1c060
y.create.l HWIO_APPS_SMMU_CB13_FAR_LOW_APPS_ADDR A:0x61e1d060
y.create.l HWIO_APPS_SMMU_CB14_FAR_LOW_APPS_ADDR A:0x61e1e060
y.create.l HWIO_APPS_SMMU_CB15_FAR_LOW_APPS_ADDR A:0x61e1f060
y.create.l HWIO_APPS_SMMU_CB0_FAR_HIGH_APPS_ADDR A:0x61e10064
y.create.l HWIO_APPS_SMMU_CB1_FAR_HIGH_APPS_ADDR A:0x61e11064
y.create.l HWIO_APPS_SMMU_CB2_FAR_HIGH_APPS_ADDR A:0x61e12064
y.create.l HWIO_APPS_SMMU_CB3_FAR_HIGH_APPS_ADDR A:0x61e13064
y.create.l HWIO_APPS_SMMU_CB4_FAR_HIGH_APPS_ADDR A:0x61e14064
y.create.l HWIO_APPS_SMMU_CB5_FAR_HIGH_APPS_ADDR A:0x61e15064
y.create.l HWIO_APPS_SMMU_CB6_FAR_HIGH_APPS_ADDR A:0x61e16064
y.create.l HWIO_APPS_SMMU_CB7_FAR_HIGH_APPS_ADDR A:0x61e17064
y.create.l HWIO_APPS_SMMU_CB8_FAR_HIGH_APPS_ADDR A:0x61e18064
y.create.l HWIO_APPS_SMMU_CB9_FAR_HIGH_APPS_ADDR A:0x61e19064
y.create.l HWIO_APPS_SMMU_CB10_FAR_HIGH_APPS_ADDR A:0x61e1a064
y.create.l HWIO_APPS_SMMU_CB11_FAR_HIGH_APPS_ADDR A:0x61e1b064
y.create.l HWIO_APPS_SMMU_CB12_FAR_HIGH_APPS_ADDR A:0x61e1c064
y.create.l HWIO_APPS_SMMU_CB13_FAR_HIGH_APPS_ADDR A:0x61e1d064
y.create.l HWIO_APPS_SMMU_CB14_FAR_HIGH_APPS_ADDR A:0x61e1e064
y.create.l HWIO_APPS_SMMU_CB15_FAR_HIGH_APPS_ADDR A:0x61e1f064
y.create.l HWIO_APPS_SMMU_CB0_FSYNR0_APPS_ADDR A:0x61e10068
y.create.l HWIO_APPS_SMMU_CB1_FSYNR0_APPS_ADDR A:0x61e11068
y.create.l HWIO_APPS_SMMU_CB2_FSYNR0_APPS_ADDR A:0x61e12068
y.create.l HWIO_APPS_SMMU_CB3_FSYNR0_APPS_ADDR A:0x61e13068
y.create.l HWIO_APPS_SMMU_CB4_FSYNR0_APPS_ADDR A:0x61e14068
y.create.l HWIO_APPS_SMMU_CB5_FSYNR0_APPS_ADDR A:0x61e15068
y.create.l HWIO_APPS_SMMU_CB6_FSYNR0_APPS_ADDR A:0x61e16068
y.create.l HWIO_APPS_SMMU_CB7_FSYNR0_APPS_ADDR A:0x61e17068
y.create.l HWIO_APPS_SMMU_CB8_FSYNR0_APPS_ADDR A:0x61e18068
y.create.l HWIO_APPS_SMMU_CB9_FSYNR0_APPS_ADDR A:0x61e19068
y.create.l HWIO_APPS_SMMU_CB10_FSYNR0_APPS_ADDR A:0x61e1a068
y.create.l HWIO_APPS_SMMU_CB11_FSYNR0_APPS_ADDR A:0x61e1b068
y.create.l HWIO_APPS_SMMU_CB12_FSYNR0_APPS_ADDR A:0x61e1c068
y.create.l HWIO_APPS_SMMU_CB13_FSYNR0_APPS_ADDR A:0x61e1d068
y.create.l HWIO_APPS_SMMU_CB14_FSYNR0_APPS_ADDR A:0x61e1e068
y.create.l HWIO_APPS_SMMU_CB15_FSYNR0_APPS_ADDR A:0x61e1f068
y.create.l HWIO_APPS_SMMU_CB0_IPAFAR_LOW_APPS_ADDR A:0x61e10070
y.create.l HWIO_APPS_SMMU_CB1_IPAFAR_LOW_APPS_ADDR A:0x61e11070
y.create.l HWIO_APPS_SMMU_CB2_IPAFAR_LOW_APPS_ADDR A:0x61e12070
y.create.l HWIO_APPS_SMMU_CB3_IPAFAR_LOW_APPS_ADDR A:0x61e13070
y.create.l HWIO_APPS_SMMU_CB4_IPAFAR_LOW_APPS_ADDR A:0x61e14070
y.create.l HWIO_APPS_SMMU_CB5_IPAFAR_LOW_APPS_ADDR A:0x61e15070
y.create.l HWIO_APPS_SMMU_CB6_IPAFAR_LOW_APPS_ADDR A:0x61e16070
y.create.l HWIO_APPS_SMMU_CB7_IPAFAR_LOW_APPS_ADDR A:0x61e17070
y.create.l HWIO_APPS_SMMU_CB8_IPAFAR_LOW_APPS_ADDR A:0x61e18070
y.create.l HWIO_APPS_SMMU_CB9_IPAFAR_LOW_APPS_ADDR A:0x61e19070
y.create.l HWIO_APPS_SMMU_CB10_IPAFAR_LOW_APPS_ADDR A:0x61e1a070
y.create.l HWIO_APPS_SMMU_CB11_IPAFAR_LOW_APPS_ADDR A:0x61e1b070
y.create.l HWIO_APPS_SMMU_CB12_IPAFAR_LOW_APPS_ADDR A:0x61e1c070
y.create.l HWIO_APPS_SMMU_CB13_IPAFAR_LOW_APPS_ADDR A:0x61e1d070
y.create.l HWIO_APPS_SMMU_CB14_IPAFAR_LOW_APPS_ADDR A:0x61e1e070
y.create.l HWIO_APPS_SMMU_CB15_IPAFAR_LOW_APPS_ADDR A:0x61e1f070
y.create.l HWIO_APPS_SMMU_CB0_IPAFAR_HIGH_APPS_ADDR A:0x61e10074
y.create.l HWIO_APPS_SMMU_CB1_IPAFAR_HIGH_APPS_ADDR A:0x61e11074
y.create.l HWIO_APPS_SMMU_CB2_IPAFAR_HIGH_APPS_ADDR A:0x61e12074
y.create.l HWIO_APPS_SMMU_CB3_IPAFAR_HIGH_APPS_ADDR A:0x61e13074
y.create.l HWIO_APPS_SMMU_CB4_IPAFAR_HIGH_APPS_ADDR A:0x61e14074
y.create.l HWIO_APPS_SMMU_CB5_IPAFAR_HIGH_APPS_ADDR A:0x61e15074
y.create.l HWIO_APPS_SMMU_CB6_IPAFAR_HIGH_APPS_ADDR A:0x61e16074
y.create.l HWIO_APPS_SMMU_CB7_IPAFAR_HIGH_APPS_ADDR A:0x61e17074
y.create.l HWIO_APPS_SMMU_CB8_IPAFAR_HIGH_APPS_ADDR A:0x61e18074
y.create.l HWIO_APPS_SMMU_CB9_IPAFAR_HIGH_APPS_ADDR A:0x61e19074
y.create.l HWIO_APPS_SMMU_CB10_IPAFAR_HIGH_APPS_ADDR A:0x61e1a074
y.create.l HWIO_APPS_SMMU_CB11_IPAFAR_HIGH_APPS_ADDR A:0x61e1b074
y.create.l HWIO_APPS_SMMU_CB12_IPAFAR_HIGH_APPS_ADDR A:0x61e1c074
y.create.l HWIO_APPS_SMMU_CB13_IPAFAR_HIGH_APPS_ADDR A:0x61e1d074
y.create.l HWIO_APPS_SMMU_CB14_IPAFAR_HIGH_APPS_ADDR A:0x61e1e074
y.create.l HWIO_APPS_SMMU_CB15_IPAFAR_HIGH_APPS_ADDR A:0x61e1f074
y.create.l HWIO_APPS_SMMU_CB0_TLBIVA_LOW_APPS_ADDR A:0x61e10600
y.create.l HWIO_APPS_SMMU_CB1_TLBIVA_LOW_APPS_ADDR A:0x61e11600
y.create.l HWIO_APPS_SMMU_CB2_TLBIVA_LOW_APPS_ADDR A:0x61e12600
y.create.l HWIO_APPS_SMMU_CB3_TLBIVA_LOW_APPS_ADDR A:0x61e13600
y.create.l HWIO_APPS_SMMU_CB4_TLBIVA_LOW_APPS_ADDR A:0x61e14600
y.create.l HWIO_APPS_SMMU_CB5_TLBIVA_LOW_APPS_ADDR A:0x61e15600
y.create.l HWIO_APPS_SMMU_CB6_TLBIVA_LOW_APPS_ADDR A:0x61e16600
y.create.l HWIO_APPS_SMMU_CB7_TLBIVA_LOW_APPS_ADDR A:0x61e17600
y.create.l HWIO_APPS_SMMU_CB8_TLBIVA_LOW_APPS_ADDR A:0x61e18600
y.create.l HWIO_APPS_SMMU_CB9_TLBIVA_LOW_APPS_ADDR A:0x61e19600
y.create.l HWIO_APPS_SMMU_CB10_TLBIVA_LOW_APPS_ADDR A:0x61e1a600
y.create.l HWIO_APPS_SMMU_CB11_TLBIVA_LOW_APPS_ADDR A:0x61e1b600
y.create.l HWIO_APPS_SMMU_CB12_TLBIVA_LOW_APPS_ADDR A:0x61e1c600
y.create.l HWIO_APPS_SMMU_CB13_TLBIVA_LOW_APPS_ADDR A:0x61e1d600
y.create.l HWIO_APPS_SMMU_CB14_TLBIVA_LOW_APPS_ADDR A:0x61e1e600
y.create.l HWIO_APPS_SMMU_CB15_TLBIVA_LOW_APPS_ADDR A:0x61e1f600
y.create.l HWIO_APPS_SMMU_CB0_TLBIVA_HIGH_APPS_ADDR A:0x61e10604
y.create.l HWIO_APPS_SMMU_CB1_TLBIVA_HIGH_APPS_ADDR A:0x61e11604
y.create.l HWIO_APPS_SMMU_CB2_TLBIVA_HIGH_APPS_ADDR A:0x61e12604
y.create.l HWIO_APPS_SMMU_CB3_TLBIVA_HIGH_APPS_ADDR A:0x61e13604
y.create.l HWIO_APPS_SMMU_CB4_TLBIVA_HIGH_APPS_ADDR A:0x61e14604
y.create.l HWIO_APPS_SMMU_CB5_TLBIVA_HIGH_APPS_ADDR A:0x61e15604
y.create.l HWIO_APPS_SMMU_CB6_TLBIVA_HIGH_APPS_ADDR A:0x61e16604
y.create.l HWIO_APPS_SMMU_CB7_TLBIVA_HIGH_APPS_ADDR A:0x61e17604
y.create.l HWIO_APPS_SMMU_CB8_TLBIVA_HIGH_APPS_ADDR A:0x61e18604
y.create.l HWIO_APPS_SMMU_CB9_TLBIVA_HIGH_APPS_ADDR A:0x61e19604
y.create.l HWIO_APPS_SMMU_CB10_TLBIVA_HIGH_APPS_ADDR A:0x61e1a604
y.create.l HWIO_APPS_SMMU_CB11_TLBIVA_HIGH_APPS_ADDR A:0x61e1b604
y.create.l HWIO_APPS_SMMU_CB12_TLBIVA_HIGH_APPS_ADDR A:0x61e1c604
y.create.l HWIO_APPS_SMMU_CB13_TLBIVA_HIGH_APPS_ADDR A:0x61e1d604
y.create.l HWIO_APPS_SMMU_CB14_TLBIVA_HIGH_APPS_ADDR A:0x61e1e604
y.create.l HWIO_APPS_SMMU_CB15_TLBIVA_HIGH_APPS_ADDR A:0x61e1f604
y.create.l HWIO_APPS_SMMU_CB0_TLBIVAA_LOW_APPS_ADDR A:0x61e10608
y.create.l HWIO_APPS_SMMU_CB1_TLBIVAA_LOW_APPS_ADDR A:0x61e11608
y.create.l HWIO_APPS_SMMU_CB2_TLBIVAA_LOW_APPS_ADDR A:0x61e12608
y.create.l HWIO_APPS_SMMU_CB3_TLBIVAA_LOW_APPS_ADDR A:0x61e13608
y.create.l HWIO_APPS_SMMU_CB4_TLBIVAA_LOW_APPS_ADDR A:0x61e14608
y.create.l HWIO_APPS_SMMU_CB5_TLBIVAA_LOW_APPS_ADDR A:0x61e15608
y.create.l HWIO_APPS_SMMU_CB6_TLBIVAA_LOW_APPS_ADDR A:0x61e16608
y.create.l HWIO_APPS_SMMU_CB7_TLBIVAA_LOW_APPS_ADDR A:0x61e17608
y.create.l HWIO_APPS_SMMU_CB8_TLBIVAA_LOW_APPS_ADDR A:0x61e18608
y.create.l HWIO_APPS_SMMU_CB9_TLBIVAA_LOW_APPS_ADDR A:0x61e19608
y.create.l HWIO_APPS_SMMU_CB10_TLBIVAA_LOW_APPS_ADDR A:0x61e1a608
y.create.l HWIO_APPS_SMMU_CB11_TLBIVAA_LOW_APPS_ADDR A:0x61e1b608
y.create.l HWIO_APPS_SMMU_CB12_TLBIVAA_LOW_APPS_ADDR A:0x61e1c608
y.create.l HWIO_APPS_SMMU_CB13_TLBIVAA_LOW_APPS_ADDR A:0x61e1d608
y.create.l HWIO_APPS_SMMU_CB14_TLBIVAA_LOW_APPS_ADDR A:0x61e1e608
y.create.l HWIO_APPS_SMMU_CB15_TLBIVAA_LOW_APPS_ADDR A:0x61e1f608
y.create.l HWIO_APPS_SMMU_CB0_TLBIVAA_HIGH_APPS_ADDR A:0x61e1060c
y.create.l HWIO_APPS_SMMU_CB1_TLBIVAA_HIGH_APPS_ADDR A:0x61e1160c
y.create.l HWIO_APPS_SMMU_CB2_TLBIVAA_HIGH_APPS_ADDR A:0x61e1260c
y.create.l HWIO_APPS_SMMU_CB3_TLBIVAA_HIGH_APPS_ADDR A:0x61e1360c
y.create.l HWIO_APPS_SMMU_CB4_TLBIVAA_HIGH_APPS_ADDR A:0x61e1460c
y.create.l HWIO_APPS_SMMU_CB5_TLBIVAA_HIGH_APPS_ADDR A:0x61e1560c
y.create.l HWIO_APPS_SMMU_CB6_TLBIVAA_HIGH_APPS_ADDR A:0x61e1660c
y.create.l HWIO_APPS_SMMU_CB7_TLBIVAA_HIGH_APPS_ADDR A:0x61e1760c
y.create.l HWIO_APPS_SMMU_CB8_TLBIVAA_HIGH_APPS_ADDR A:0x61e1860c
y.create.l HWIO_APPS_SMMU_CB9_TLBIVAA_HIGH_APPS_ADDR A:0x61e1960c
y.create.l HWIO_APPS_SMMU_CB10_TLBIVAA_HIGH_APPS_ADDR A:0x61e1a60c
y.create.l HWIO_APPS_SMMU_CB11_TLBIVAA_HIGH_APPS_ADDR A:0x61e1b60c
y.create.l HWIO_APPS_SMMU_CB12_TLBIVAA_HIGH_APPS_ADDR A:0x61e1c60c
y.create.l HWIO_APPS_SMMU_CB13_TLBIVAA_HIGH_APPS_ADDR A:0x61e1d60c
y.create.l HWIO_APPS_SMMU_CB14_TLBIVAA_HIGH_APPS_ADDR A:0x61e1e60c
y.create.l HWIO_APPS_SMMU_CB15_TLBIVAA_HIGH_APPS_ADDR A:0x61e1f60c
y.create.l HWIO_APPS_SMMU_CB0_TLBIASID_APPS_ADDR A:0x61e10610
y.create.l HWIO_APPS_SMMU_CB1_TLBIASID_APPS_ADDR A:0x61e11610
y.create.l HWIO_APPS_SMMU_CB2_TLBIASID_APPS_ADDR A:0x61e12610
y.create.l HWIO_APPS_SMMU_CB3_TLBIASID_APPS_ADDR A:0x61e13610
y.create.l HWIO_APPS_SMMU_CB4_TLBIASID_APPS_ADDR A:0x61e14610
y.create.l HWIO_APPS_SMMU_CB5_TLBIASID_APPS_ADDR A:0x61e15610
y.create.l HWIO_APPS_SMMU_CB6_TLBIASID_APPS_ADDR A:0x61e16610
y.create.l HWIO_APPS_SMMU_CB7_TLBIASID_APPS_ADDR A:0x61e17610
y.create.l HWIO_APPS_SMMU_CB8_TLBIASID_APPS_ADDR A:0x61e18610
y.create.l HWIO_APPS_SMMU_CB9_TLBIASID_APPS_ADDR A:0x61e19610
y.create.l HWIO_APPS_SMMU_CB10_TLBIASID_APPS_ADDR A:0x61e1a610
y.create.l HWIO_APPS_SMMU_CB11_TLBIASID_APPS_ADDR A:0x61e1b610
y.create.l HWIO_APPS_SMMU_CB12_TLBIASID_APPS_ADDR A:0x61e1c610
y.create.l HWIO_APPS_SMMU_CB13_TLBIASID_APPS_ADDR A:0x61e1d610
y.create.l HWIO_APPS_SMMU_CB14_TLBIASID_APPS_ADDR A:0x61e1e610
y.create.l HWIO_APPS_SMMU_CB15_TLBIASID_APPS_ADDR A:0x61e1f610
y.create.l HWIO_APPS_SMMU_CB0_TLBIALL_APPS_ADDR A:0x61e10618
y.create.l HWIO_APPS_SMMU_CB1_TLBIALL_APPS_ADDR A:0x61e11618
y.create.l HWIO_APPS_SMMU_CB2_TLBIALL_APPS_ADDR A:0x61e12618
y.create.l HWIO_APPS_SMMU_CB3_TLBIALL_APPS_ADDR A:0x61e13618
y.create.l HWIO_APPS_SMMU_CB4_TLBIALL_APPS_ADDR A:0x61e14618
y.create.l HWIO_APPS_SMMU_CB5_TLBIALL_APPS_ADDR A:0x61e15618
y.create.l HWIO_APPS_SMMU_CB6_TLBIALL_APPS_ADDR A:0x61e16618
y.create.l HWIO_APPS_SMMU_CB7_TLBIALL_APPS_ADDR A:0x61e17618
y.create.l HWIO_APPS_SMMU_CB8_TLBIALL_APPS_ADDR A:0x61e18618
y.create.l HWIO_APPS_SMMU_CB9_TLBIALL_APPS_ADDR A:0x61e19618
y.create.l HWIO_APPS_SMMU_CB10_TLBIALL_APPS_ADDR A:0x61e1a618
y.create.l HWIO_APPS_SMMU_CB11_TLBIALL_APPS_ADDR A:0x61e1b618
y.create.l HWIO_APPS_SMMU_CB12_TLBIALL_APPS_ADDR A:0x61e1c618
y.create.l HWIO_APPS_SMMU_CB13_TLBIALL_APPS_ADDR A:0x61e1d618
y.create.l HWIO_APPS_SMMU_CB14_TLBIALL_APPS_ADDR A:0x61e1e618
y.create.l HWIO_APPS_SMMU_CB15_TLBIALL_APPS_ADDR A:0x61e1f618
y.create.l HWIO_APPS_SMMU_CB0_TLBIVAL_LOW_APPS_ADDR A:0x61e10620
y.create.l HWIO_APPS_SMMU_CB1_TLBIVAL_LOW_APPS_ADDR A:0x61e11620
y.create.l HWIO_APPS_SMMU_CB2_TLBIVAL_LOW_APPS_ADDR A:0x61e12620
y.create.l HWIO_APPS_SMMU_CB3_TLBIVAL_LOW_APPS_ADDR A:0x61e13620
y.create.l HWIO_APPS_SMMU_CB4_TLBIVAL_LOW_APPS_ADDR A:0x61e14620
y.create.l HWIO_APPS_SMMU_CB5_TLBIVAL_LOW_APPS_ADDR A:0x61e15620
y.create.l HWIO_APPS_SMMU_CB6_TLBIVAL_LOW_APPS_ADDR A:0x61e16620
y.create.l HWIO_APPS_SMMU_CB7_TLBIVAL_LOW_APPS_ADDR A:0x61e17620
y.create.l HWIO_APPS_SMMU_CB8_TLBIVAL_LOW_APPS_ADDR A:0x61e18620
y.create.l HWIO_APPS_SMMU_CB9_TLBIVAL_LOW_APPS_ADDR A:0x61e19620
y.create.l HWIO_APPS_SMMU_CB10_TLBIVAL_LOW_APPS_ADDR A:0x61e1a620
y.create.l HWIO_APPS_SMMU_CB11_TLBIVAL_LOW_APPS_ADDR A:0x61e1b620
y.create.l HWIO_APPS_SMMU_CB12_TLBIVAL_LOW_APPS_ADDR A:0x61e1c620
y.create.l HWIO_APPS_SMMU_CB13_TLBIVAL_LOW_APPS_ADDR A:0x61e1d620
y.create.l HWIO_APPS_SMMU_CB14_TLBIVAL_LOW_APPS_ADDR A:0x61e1e620
y.create.l HWIO_APPS_SMMU_CB15_TLBIVAL_LOW_APPS_ADDR A:0x61e1f620
y.create.l HWIO_APPS_SMMU_CB0_TLBIVAL_HIGH_APPS_ADDR A:0x61e10624
y.create.l HWIO_APPS_SMMU_CB1_TLBIVAL_HIGH_APPS_ADDR A:0x61e11624
y.create.l HWIO_APPS_SMMU_CB2_TLBIVAL_HIGH_APPS_ADDR A:0x61e12624
y.create.l HWIO_APPS_SMMU_CB3_TLBIVAL_HIGH_APPS_ADDR A:0x61e13624
y.create.l HWIO_APPS_SMMU_CB4_TLBIVAL_HIGH_APPS_ADDR A:0x61e14624
y.create.l HWIO_APPS_SMMU_CB5_TLBIVAL_HIGH_APPS_ADDR A:0x61e15624
y.create.l HWIO_APPS_SMMU_CB6_TLBIVAL_HIGH_APPS_ADDR A:0x61e16624
y.create.l HWIO_APPS_SMMU_CB7_TLBIVAL_HIGH_APPS_ADDR A:0x61e17624
y.create.l HWIO_APPS_SMMU_CB8_TLBIVAL_HIGH_APPS_ADDR A:0x61e18624
y.create.l HWIO_APPS_SMMU_CB9_TLBIVAL_HIGH_APPS_ADDR A:0x61e19624
y.create.l HWIO_APPS_SMMU_CB10_TLBIVAL_HIGH_APPS_ADDR A:0x61e1a624
y.create.l HWIO_APPS_SMMU_CB11_TLBIVAL_HIGH_APPS_ADDR A:0x61e1b624
y.create.l HWIO_APPS_SMMU_CB12_TLBIVAL_HIGH_APPS_ADDR A:0x61e1c624
y.create.l HWIO_APPS_SMMU_CB13_TLBIVAL_HIGH_APPS_ADDR A:0x61e1d624
y.create.l HWIO_APPS_SMMU_CB14_TLBIVAL_HIGH_APPS_ADDR A:0x61e1e624
y.create.l HWIO_APPS_SMMU_CB15_TLBIVAL_HIGH_APPS_ADDR A:0x61e1f624
y.create.l HWIO_APPS_SMMU_CB0_TLBIVAAL_LOW_APPS_ADDR A:0x61e10628
y.create.l HWIO_APPS_SMMU_CB1_TLBIVAAL_LOW_APPS_ADDR A:0x61e11628
y.create.l HWIO_APPS_SMMU_CB2_TLBIVAAL_LOW_APPS_ADDR A:0x61e12628
y.create.l HWIO_APPS_SMMU_CB3_TLBIVAAL_LOW_APPS_ADDR A:0x61e13628
y.create.l HWIO_APPS_SMMU_CB4_TLBIVAAL_LOW_APPS_ADDR A:0x61e14628
y.create.l HWIO_APPS_SMMU_CB5_TLBIVAAL_LOW_APPS_ADDR A:0x61e15628
y.create.l HWIO_APPS_SMMU_CB6_TLBIVAAL_LOW_APPS_ADDR A:0x61e16628
y.create.l HWIO_APPS_SMMU_CB7_TLBIVAAL_LOW_APPS_ADDR A:0x61e17628
y.create.l HWIO_APPS_SMMU_CB8_TLBIVAAL_LOW_APPS_ADDR A:0x61e18628
y.create.l HWIO_APPS_SMMU_CB9_TLBIVAAL_LOW_APPS_ADDR A:0x61e19628
y.create.l HWIO_APPS_SMMU_CB10_TLBIVAAL_LOW_APPS_ADDR A:0x61e1a628
y.create.l HWIO_APPS_SMMU_CB11_TLBIVAAL_LOW_APPS_ADDR A:0x61e1b628
y.create.l HWIO_APPS_SMMU_CB12_TLBIVAAL_LOW_APPS_ADDR A:0x61e1c628
y.create.l HWIO_APPS_SMMU_CB13_TLBIVAAL_LOW_APPS_ADDR A:0x61e1d628
y.create.l HWIO_APPS_SMMU_CB14_TLBIVAAL_LOW_APPS_ADDR A:0x61e1e628
y.create.l HWIO_APPS_SMMU_CB15_TLBIVAAL_LOW_APPS_ADDR A:0x61e1f628
y.create.l HWIO_APPS_SMMU_CB0_TLBIVAAL_HIGH_APPS_ADDR A:0x61e1062c
y.create.l HWIO_APPS_SMMU_CB1_TLBIVAAL_HIGH_APPS_ADDR A:0x61e1162c
y.create.l HWIO_APPS_SMMU_CB2_TLBIVAAL_HIGH_APPS_ADDR A:0x61e1262c
y.create.l HWIO_APPS_SMMU_CB3_TLBIVAAL_HIGH_APPS_ADDR A:0x61e1362c
y.create.l HWIO_APPS_SMMU_CB4_TLBIVAAL_HIGH_APPS_ADDR A:0x61e1462c
y.create.l HWIO_APPS_SMMU_CB5_TLBIVAAL_HIGH_APPS_ADDR A:0x61e1562c
y.create.l HWIO_APPS_SMMU_CB6_TLBIVAAL_HIGH_APPS_ADDR A:0x61e1662c
y.create.l HWIO_APPS_SMMU_CB7_TLBIVAAL_HIGH_APPS_ADDR A:0x61e1762c
y.create.l HWIO_APPS_SMMU_CB8_TLBIVAAL_HIGH_APPS_ADDR A:0x61e1862c
y.create.l HWIO_APPS_SMMU_CB9_TLBIVAAL_HIGH_APPS_ADDR A:0x61e1962c
y.create.l HWIO_APPS_SMMU_CB10_TLBIVAAL_HIGH_APPS_ADDR A:0x61e1a62c
y.create.l HWIO_APPS_SMMU_CB11_TLBIVAAL_HIGH_APPS_ADDR A:0x61e1b62c
y.create.l HWIO_APPS_SMMU_CB12_TLBIVAAL_HIGH_APPS_ADDR A:0x61e1c62c
y.create.l HWIO_APPS_SMMU_CB13_TLBIVAAL_HIGH_APPS_ADDR A:0x61e1d62c
y.create.l HWIO_APPS_SMMU_CB14_TLBIVAAL_HIGH_APPS_ADDR A:0x61e1e62c
y.create.l HWIO_APPS_SMMU_CB15_TLBIVAAL_HIGH_APPS_ADDR A:0x61e1f62c
y.create.l HWIO_APPS_SMMU_CB0_TLBIIPAS2_LOW_APPS_ADDR A:0x61e10630
y.create.l HWIO_APPS_SMMU_CB1_TLBIIPAS2_LOW_APPS_ADDR A:0x61e11630
y.create.l HWIO_APPS_SMMU_CB2_TLBIIPAS2_LOW_APPS_ADDR A:0x61e12630
y.create.l HWIO_APPS_SMMU_CB3_TLBIIPAS2_LOW_APPS_ADDR A:0x61e13630
y.create.l HWIO_APPS_SMMU_CB4_TLBIIPAS2_LOW_APPS_ADDR A:0x61e14630
y.create.l HWIO_APPS_SMMU_CB5_TLBIIPAS2_LOW_APPS_ADDR A:0x61e15630
y.create.l HWIO_APPS_SMMU_CB6_TLBIIPAS2_LOW_APPS_ADDR A:0x61e16630
y.create.l HWIO_APPS_SMMU_CB7_TLBIIPAS2_LOW_APPS_ADDR A:0x61e17630
y.create.l HWIO_APPS_SMMU_CB8_TLBIIPAS2_LOW_APPS_ADDR A:0x61e18630
y.create.l HWIO_APPS_SMMU_CB9_TLBIIPAS2_LOW_APPS_ADDR A:0x61e19630
y.create.l HWIO_APPS_SMMU_CB10_TLBIIPAS2_LOW_APPS_ADDR A:0x61e1a630
y.create.l HWIO_APPS_SMMU_CB11_TLBIIPAS2_LOW_APPS_ADDR A:0x61e1b630
y.create.l HWIO_APPS_SMMU_CB12_TLBIIPAS2_LOW_APPS_ADDR A:0x61e1c630
y.create.l HWIO_APPS_SMMU_CB13_TLBIIPAS2_LOW_APPS_ADDR A:0x61e1d630
y.create.l HWIO_APPS_SMMU_CB14_TLBIIPAS2_LOW_APPS_ADDR A:0x61e1e630
y.create.l HWIO_APPS_SMMU_CB15_TLBIIPAS2_LOW_APPS_ADDR A:0x61e1f630
y.create.l HWIO_APPS_SMMU_CB0_TLBIIPAS2_HIGH_APPS_ADDR A:0x61e10634
y.create.l HWIO_APPS_SMMU_CB1_TLBIIPAS2_HIGH_APPS_ADDR A:0x61e11634
y.create.l HWIO_APPS_SMMU_CB2_TLBIIPAS2_HIGH_APPS_ADDR A:0x61e12634
y.create.l HWIO_APPS_SMMU_CB3_TLBIIPAS2_HIGH_APPS_ADDR A:0x61e13634
y.create.l HWIO_APPS_SMMU_CB4_TLBIIPAS2_HIGH_APPS_ADDR A:0x61e14634
y.create.l HWIO_APPS_SMMU_CB5_TLBIIPAS2_HIGH_APPS_ADDR A:0x61e15634
y.create.l HWIO_APPS_SMMU_CB6_TLBIIPAS2_HIGH_APPS_ADDR A:0x61e16634
y.create.l HWIO_APPS_SMMU_CB7_TLBIIPAS2_HIGH_APPS_ADDR A:0x61e17634
y.create.l HWIO_APPS_SMMU_CB8_TLBIIPAS2_HIGH_APPS_ADDR A:0x61e18634
y.create.l HWIO_APPS_SMMU_CB9_TLBIIPAS2_HIGH_APPS_ADDR A:0x61e19634
y.create.l HWIO_APPS_SMMU_CB10_TLBIIPAS2_HIGH_APPS_ADDR A:0x61e1a634
y.create.l HWIO_APPS_SMMU_CB11_TLBIIPAS2_HIGH_APPS_ADDR A:0x61e1b634
y.create.l HWIO_APPS_SMMU_CB12_TLBIIPAS2_HIGH_APPS_ADDR A:0x61e1c634
y.create.l HWIO_APPS_SMMU_CB13_TLBIIPAS2_HIGH_APPS_ADDR A:0x61e1d634
y.create.l HWIO_APPS_SMMU_CB14_TLBIIPAS2_HIGH_APPS_ADDR A:0x61e1e634
y.create.l HWIO_APPS_SMMU_CB15_TLBIIPAS2_HIGH_APPS_ADDR A:0x61e1f634
y.create.l HWIO_APPS_SMMU_CB0_TLBIIPAS2L_LOW_APPS_ADDR A:0x61e10638
y.create.l HWIO_APPS_SMMU_CB1_TLBIIPAS2L_LOW_APPS_ADDR A:0x61e11638
y.create.l HWIO_APPS_SMMU_CB2_TLBIIPAS2L_LOW_APPS_ADDR A:0x61e12638
y.create.l HWIO_APPS_SMMU_CB3_TLBIIPAS2L_LOW_APPS_ADDR A:0x61e13638
y.create.l HWIO_APPS_SMMU_CB4_TLBIIPAS2L_LOW_APPS_ADDR A:0x61e14638
y.create.l HWIO_APPS_SMMU_CB5_TLBIIPAS2L_LOW_APPS_ADDR A:0x61e15638
y.create.l HWIO_APPS_SMMU_CB6_TLBIIPAS2L_LOW_APPS_ADDR A:0x61e16638
y.create.l HWIO_APPS_SMMU_CB7_TLBIIPAS2L_LOW_APPS_ADDR A:0x61e17638
y.create.l HWIO_APPS_SMMU_CB8_TLBIIPAS2L_LOW_APPS_ADDR A:0x61e18638
y.create.l HWIO_APPS_SMMU_CB9_TLBIIPAS2L_LOW_APPS_ADDR A:0x61e19638
y.create.l HWIO_APPS_SMMU_CB10_TLBIIPAS2L_LOW_APPS_ADDR A:0x61e1a638
y.create.l HWIO_APPS_SMMU_CB11_TLBIIPAS2L_LOW_APPS_ADDR A:0x61e1b638
y.create.l HWIO_APPS_SMMU_CB12_TLBIIPAS2L_LOW_APPS_ADDR A:0x61e1c638
y.create.l HWIO_APPS_SMMU_CB13_TLBIIPAS2L_LOW_APPS_ADDR A:0x61e1d638
y.create.l HWIO_APPS_SMMU_CB14_TLBIIPAS2L_LOW_APPS_ADDR A:0x61e1e638
y.create.l HWIO_APPS_SMMU_CB15_TLBIIPAS2L_LOW_APPS_ADDR A:0x61e1f638
y.create.l HWIO_APPS_SMMU_CB0_TLBIIPAS2L_HIGH_APPS_ADDR A:0x61e1063c
y.create.l HWIO_APPS_SMMU_CB1_TLBIIPAS2L_HIGH_APPS_ADDR A:0x61e1163c
y.create.l HWIO_APPS_SMMU_CB2_TLBIIPAS2L_HIGH_APPS_ADDR A:0x61e1263c
y.create.l HWIO_APPS_SMMU_CB3_TLBIIPAS2L_HIGH_APPS_ADDR A:0x61e1363c
y.create.l HWIO_APPS_SMMU_CB4_TLBIIPAS2L_HIGH_APPS_ADDR A:0x61e1463c
y.create.l HWIO_APPS_SMMU_CB5_TLBIIPAS2L_HIGH_APPS_ADDR A:0x61e1563c
y.create.l HWIO_APPS_SMMU_CB6_TLBIIPAS2L_HIGH_APPS_ADDR A:0x61e1663c
y.create.l HWIO_APPS_SMMU_CB7_TLBIIPAS2L_HIGH_APPS_ADDR A:0x61e1763c
y.create.l HWIO_APPS_SMMU_CB8_TLBIIPAS2L_HIGH_APPS_ADDR A:0x61e1863c
y.create.l HWIO_APPS_SMMU_CB9_TLBIIPAS2L_HIGH_APPS_ADDR A:0x61e1963c
y.create.l HWIO_APPS_SMMU_CB10_TLBIIPAS2L_HIGH_APPS_ADDR A:0x61e1a63c
y.create.l HWIO_APPS_SMMU_CB11_TLBIIPAS2L_HIGH_APPS_ADDR A:0x61e1b63c
y.create.l HWIO_APPS_SMMU_CB12_TLBIIPAS2L_HIGH_APPS_ADDR A:0x61e1c63c
y.create.l HWIO_APPS_SMMU_CB13_TLBIIPAS2L_HIGH_APPS_ADDR A:0x61e1d63c
y.create.l HWIO_APPS_SMMU_CB14_TLBIIPAS2L_HIGH_APPS_ADDR A:0x61e1e63c
y.create.l HWIO_APPS_SMMU_CB15_TLBIIPAS2L_HIGH_APPS_ADDR A:0x61e1f63c
y.create.l HWIO_APPS_SMMU_CB0_TLBSYNC_APPS_ADDR A:0x61e107f0
y.create.l HWIO_APPS_SMMU_CB1_TLBSYNC_APPS_ADDR A:0x61e117f0
y.create.l HWIO_APPS_SMMU_CB2_TLBSYNC_APPS_ADDR A:0x61e127f0
y.create.l HWIO_APPS_SMMU_CB3_TLBSYNC_APPS_ADDR A:0x61e137f0
y.create.l HWIO_APPS_SMMU_CB4_TLBSYNC_APPS_ADDR A:0x61e147f0
y.create.l HWIO_APPS_SMMU_CB5_TLBSYNC_APPS_ADDR A:0x61e157f0
y.create.l HWIO_APPS_SMMU_CB6_TLBSYNC_APPS_ADDR A:0x61e167f0
y.create.l HWIO_APPS_SMMU_CB7_TLBSYNC_APPS_ADDR A:0x61e177f0
y.create.l HWIO_APPS_SMMU_CB8_TLBSYNC_APPS_ADDR A:0x61e187f0
y.create.l HWIO_APPS_SMMU_CB9_TLBSYNC_APPS_ADDR A:0x61e197f0
y.create.l HWIO_APPS_SMMU_CB10_TLBSYNC_APPS_ADDR A:0x61e1a7f0
y.create.l HWIO_APPS_SMMU_CB11_TLBSYNC_APPS_ADDR A:0x61e1b7f0
y.create.l HWIO_APPS_SMMU_CB12_TLBSYNC_APPS_ADDR A:0x61e1c7f0
y.create.l HWIO_APPS_SMMU_CB13_TLBSYNC_APPS_ADDR A:0x61e1d7f0
y.create.l HWIO_APPS_SMMU_CB14_TLBSYNC_APPS_ADDR A:0x61e1e7f0
y.create.l HWIO_APPS_SMMU_CB15_TLBSYNC_APPS_ADDR A:0x61e1f7f0
y.create.l HWIO_APPS_SMMU_CB0_TLBSTATUS_APPS_ADDR A:0x61e107f4
y.create.l HWIO_APPS_SMMU_CB1_TLBSTATUS_APPS_ADDR A:0x61e117f4
y.create.l HWIO_APPS_SMMU_CB2_TLBSTATUS_APPS_ADDR A:0x61e127f4
y.create.l HWIO_APPS_SMMU_CB3_TLBSTATUS_APPS_ADDR A:0x61e137f4
y.create.l HWIO_APPS_SMMU_CB4_TLBSTATUS_APPS_ADDR A:0x61e147f4
y.create.l HWIO_APPS_SMMU_CB5_TLBSTATUS_APPS_ADDR A:0x61e157f4
y.create.l HWIO_APPS_SMMU_CB6_TLBSTATUS_APPS_ADDR A:0x61e167f4
y.create.l HWIO_APPS_SMMU_CB7_TLBSTATUS_APPS_ADDR A:0x61e177f4
y.create.l HWIO_APPS_SMMU_CB8_TLBSTATUS_APPS_ADDR A:0x61e187f4
y.create.l HWIO_APPS_SMMU_CB9_TLBSTATUS_APPS_ADDR A:0x61e197f4
y.create.l HWIO_APPS_SMMU_CB10_TLBSTATUS_APPS_ADDR A:0x61e1a7f4
y.create.l HWIO_APPS_SMMU_CB11_TLBSTATUS_APPS_ADDR A:0x61e1b7f4
y.create.l HWIO_APPS_SMMU_CB12_TLBSTATUS_APPS_ADDR A:0x61e1c7f4
y.create.l HWIO_APPS_SMMU_CB13_TLBSTATUS_APPS_ADDR A:0x61e1d7f4
y.create.l HWIO_APPS_SMMU_CB14_TLBSTATUS_APPS_ADDR A:0x61e1e7f4
y.create.l HWIO_APPS_SMMU_CB15_TLBSTATUS_APPS_ADDR A:0x61e1f7f4
y.create.l HWIO_APPS_SMMU_CB0_PMEVCNTR0_APPS_ADDR A:0x61e10e00
y.create.l HWIO_APPS_SMMU_CB1_PMEVCNTR0_APPS_ADDR A:0x61e11e00
y.create.l HWIO_APPS_SMMU_CB2_PMEVCNTR0_APPS_ADDR A:0x61e12e00
y.create.l HWIO_APPS_SMMU_CB3_PMEVCNTR0_APPS_ADDR A:0x61e13e00
y.create.l HWIO_APPS_SMMU_CB4_PMEVCNTR0_APPS_ADDR A:0x61e14e00
y.create.l HWIO_APPS_SMMU_CB5_PMEVCNTR0_APPS_ADDR A:0x61e15e00
y.create.l HWIO_APPS_SMMU_CB6_PMEVCNTR0_APPS_ADDR A:0x61e16e00
y.create.l HWIO_APPS_SMMU_CB7_PMEVCNTR0_APPS_ADDR A:0x61e17e00
y.create.l HWIO_APPS_SMMU_CB8_PMEVCNTR0_APPS_ADDR A:0x61e18e00
y.create.l HWIO_APPS_SMMU_CB9_PMEVCNTR0_APPS_ADDR A:0x61e19e00
y.create.l HWIO_APPS_SMMU_CB10_PMEVCNTR0_APPS_ADDR A:0x61e1ae00
y.create.l HWIO_APPS_SMMU_CB11_PMEVCNTR0_APPS_ADDR A:0x61e1be00
y.create.l HWIO_APPS_SMMU_CB12_PMEVCNTR0_APPS_ADDR A:0x61e1ce00
y.create.l HWIO_APPS_SMMU_CB13_PMEVCNTR0_APPS_ADDR A:0x61e1de00
y.create.l HWIO_APPS_SMMU_CB14_PMEVCNTR0_APPS_ADDR A:0x61e1ee00
y.create.l HWIO_APPS_SMMU_CB15_PMEVCNTR0_APPS_ADDR A:0x61e1fe00
y.create.l HWIO_APPS_SMMU_CB0_PMEVCNTR1_APPS_ADDR A:0x61e10e04
y.create.l HWIO_APPS_SMMU_CB1_PMEVCNTR1_APPS_ADDR A:0x61e11e04
y.create.l HWIO_APPS_SMMU_CB2_PMEVCNTR1_APPS_ADDR A:0x61e12e04
y.create.l HWIO_APPS_SMMU_CB3_PMEVCNTR1_APPS_ADDR A:0x61e13e04
y.create.l HWIO_APPS_SMMU_CB4_PMEVCNTR1_APPS_ADDR A:0x61e14e04
y.create.l HWIO_APPS_SMMU_CB5_PMEVCNTR1_APPS_ADDR A:0x61e15e04
y.create.l HWIO_APPS_SMMU_CB6_PMEVCNTR1_APPS_ADDR A:0x61e16e04
y.create.l HWIO_APPS_SMMU_CB7_PMEVCNTR1_APPS_ADDR A:0x61e17e04
y.create.l HWIO_APPS_SMMU_CB8_PMEVCNTR1_APPS_ADDR A:0x61e18e04
y.create.l HWIO_APPS_SMMU_CB9_PMEVCNTR1_APPS_ADDR A:0x61e19e04
y.create.l HWIO_APPS_SMMU_CB10_PMEVCNTR1_APPS_ADDR A:0x61e1ae04
y.create.l HWIO_APPS_SMMU_CB11_PMEVCNTR1_APPS_ADDR A:0x61e1be04
y.create.l HWIO_APPS_SMMU_CB12_PMEVCNTR1_APPS_ADDR A:0x61e1ce04
y.create.l HWIO_APPS_SMMU_CB13_PMEVCNTR1_APPS_ADDR A:0x61e1de04
y.create.l HWIO_APPS_SMMU_CB14_PMEVCNTR1_APPS_ADDR A:0x61e1ee04
y.create.l HWIO_APPS_SMMU_CB15_PMEVCNTR1_APPS_ADDR A:0x61e1fe04
y.create.l HWIO_APPS_SMMU_CB0_PMEVCNTR2_APPS_ADDR A:0x61e10e08
y.create.l HWIO_APPS_SMMU_CB1_PMEVCNTR2_APPS_ADDR A:0x61e11e08
y.create.l HWIO_APPS_SMMU_CB2_PMEVCNTR2_APPS_ADDR A:0x61e12e08
y.create.l HWIO_APPS_SMMU_CB3_PMEVCNTR2_APPS_ADDR A:0x61e13e08
y.create.l HWIO_APPS_SMMU_CB4_PMEVCNTR2_APPS_ADDR A:0x61e14e08
y.create.l HWIO_APPS_SMMU_CB5_PMEVCNTR2_APPS_ADDR A:0x61e15e08
y.create.l HWIO_APPS_SMMU_CB6_PMEVCNTR2_APPS_ADDR A:0x61e16e08
y.create.l HWIO_APPS_SMMU_CB7_PMEVCNTR2_APPS_ADDR A:0x61e17e08
y.create.l HWIO_APPS_SMMU_CB8_PMEVCNTR2_APPS_ADDR A:0x61e18e08
y.create.l HWIO_APPS_SMMU_CB9_PMEVCNTR2_APPS_ADDR A:0x61e19e08
y.create.l HWIO_APPS_SMMU_CB10_PMEVCNTR2_APPS_ADDR A:0x61e1ae08
y.create.l HWIO_APPS_SMMU_CB11_PMEVCNTR2_APPS_ADDR A:0x61e1be08
y.create.l HWIO_APPS_SMMU_CB12_PMEVCNTR2_APPS_ADDR A:0x61e1ce08
y.create.l HWIO_APPS_SMMU_CB13_PMEVCNTR2_APPS_ADDR A:0x61e1de08
y.create.l HWIO_APPS_SMMU_CB14_PMEVCNTR2_APPS_ADDR A:0x61e1ee08
y.create.l HWIO_APPS_SMMU_CB15_PMEVCNTR2_APPS_ADDR A:0x61e1fe08
y.create.l HWIO_APPS_SMMU_CB0_PMEVCNTR3_APPS_ADDR A:0x61e10e0c
y.create.l HWIO_APPS_SMMU_CB1_PMEVCNTR3_APPS_ADDR A:0x61e11e0c
y.create.l HWIO_APPS_SMMU_CB2_PMEVCNTR3_APPS_ADDR A:0x61e12e0c
y.create.l HWIO_APPS_SMMU_CB3_PMEVCNTR3_APPS_ADDR A:0x61e13e0c
y.create.l HWIO_APPS_SMMU_CB4_PMEVCNTR3_APPS_ADDR A:0x61e14e0c
y.create.l HWIO_APPS_SMMU_CB5_PMEVCNTR3_APPS_ADDR A:0x61e15e0c
y.create.l HWIO_APPS_SMMU_CB6_PMEVCNTR3_APPS_ADDR A:0x61e16e0c
y.create.l HWIO_APPS_SMMU_CB7_PMEVCNTR3_APPS_ADDR A:0x61e17e0c
y.create.l HWIO_APPS_SMMU_CB8_PMEVCNTR3_APPS_ADDR A:0x61e18e0c
y.create.l HWIO_APPS_SMMU_CB9_PMEVCNTR3_APPS_ADDR A:0x61e19e0c
y.create.l HWIO_APPS_SMMU_CB10_PMEVCNTR3_APPS_ADDR A:0x61e1ae0c
y.create.l HWIO_APPS_SMMU_CB11_PMEVCNTR3_APPS_ADDR A:0x61e1be0c
y.create.l HWIO_APPS_SMMU_CB12_PMEVCNTR3_APPS_ADDR A:0x61e1ce0c
y.create.l HWIO_APPS_SMMU_CB13_PMEVCNTR3_APPS_ADDR A:0x61e1de0c
y.create.l HWIO_APPS_SMMU_CB14_PMEVCNTR3_APPS_ADDR A:0x61e1ee0c
y.create.l HWIO_APPS_SMMU_CB15_PMEVCNTR3_APPS_ADDR A:0x61e1fe0c
y.create.l HWIO_APPS_SMMU_CB0_PMEVTYPER0_APPS_ADDR A:0x61e10e80
y.create.l HWIO_APPS_SMMU_CB1_PMEVTYPER0_APPS_ADDR A:0x61e11e80
y.create.l HWIO_APPS_SMMU_CB2_PMEVTYPER0_APPS_ADDR A:0x61e12e80
y.create.l HWIO_APPS_SMMU_CB3_PMEVTYPER0_APPS_ADDR A:0x61e13e80
y.create.l HWIO_APPS_SMMU_CB4_PMEVTYPER0_APPS_ADDR A:0x61e14e80
y.create.l HWIO_APPS_SMMU_CB5_PMEVTYPER0_APPS_ADDR A:0x61e15e80
y.create.l HWIO_APPS_SMMU_CB6_PMEVTYPER0_APPS_ADDR A:0x61e16e80
y.create.l HWIO_APPS_SMMU_CB7_PMEVTYPER0_APPS_ADDR A:0x61e17e80
y.create.l HWIO_APPS_SMMU_CB8_PMEVTYPER0_APPS_ADDR A:0x61e18e80
y.create.l HWIO_APPS_SMMU_CB9_PMEVTYPER0_APPS_ADDR A:0x61e19e80
y.create.l HWIO_APPS_SMMU_CB10_PMEVTYPER0_APPS_ADDR A:0x61e1ae80
y.create.l HWIO_APPS_SMMU_CB11_PMEVTYPER0_APPS_ADDR A:0x61e1be80
y.create.l HWIO_APPS_SMMU_CB12_PMEVTYPER0_APPS_ADDR A:0x61e1ce80
y.create.l HWIO_APPS_SMMU_CB13_PMEVTYPER0_APPS_ADDR A:0x61e1de80
y.create.l HWIO_APPS_SMMU_CB14_PMEVTYPER0_APPS_ADDR A:0x61e1ee80
y.create.l HWIO_APPS_SMMU_CB15_PMEVTYPER0_APPS_ADDR A:0x61e1fe80
y.create.l HWIO_APPS_SMMU_CB0_PMEVTYPER1_APPS_ADDR A:0x61e10e84
y.create.l HWIO_APPS_SMMU_CB1_PMEVTYPER1_APPS_ADDR A:0x61e11e84
y.create.l HWIO_APPS_SMMU_CB2_PMEVTYPER1_APPS_ADDR A:0x61e12e84
y.create.l HWIO_APPS_SMMU_CB3_PMEVTYPER1_APPS_ADDR A:0x61e13e84
y.create.l HWIO_APPS_SMMU_CB4_PMEVTYPER1_APPS_ADDR A:0x61e14e84
y.create.l HWIO_APPS_SMMU_CB5_PMEVTYPER1_APPS_ADDR A:0x61e15e84
y.create.l HWIO_APPS_SMMU_CB6_PMEVTYPER1_APPS_ADDR A:0x61e16e84
y.create.l HWIO_APPS_SMMU_CB7_PMEVTYPER1_APPS_ADDR A:0x61e17e84
y.create.l HWIO_APPS_SMMU_CB8_PMEVTYPER1_APPS_ADDR A:0x61e18e84
y.create.l HWIO_APPS_SMMU_CB9_PMEVTYPER1_APPS_ADDR A:0x61e19e84
y.create.l HWIO_APPS_SMMU_CB10_PMEVTYPER1_APPS_ADDR A:0x61e1ae84
y.create.l HWIO_APPS_SMMU_CB11_PMEVTYPER1_APPS_ADDR A:0x61e1be84
y.create.l HWIO_APPS_SMMU_CB12_PMEVTYPER1_APPS_ADDR A:0x61e1ce84
y.create.l HWIO_APPS_SMMU_CB13_PMEVTYPER1_APPS_ADDR A:0x61e1de84
y.create.l HWIO_APPS_SMMU_CB14_PMEVTYPER1_APPS_ADDR A:0x61e1ee84
y.create.l HWIO_APPS_SMMU_CB15_PMEVTYPER1_APPS_ADDR A:0x61e1fe84
y.create.l HWIO_APPS_SMMU_CB0_PMEVTYPER2_APPS_ADDR A:0x61e10e88
y.create.l HWIO_APPS_SMMU_CB1_PMEVTYPER2_APPS_ADDR A:0x61e11e88
y.create.l HWIO_APPS_SMMU_CB2_PMEVTYPER2_APPS_ADDR A:0x61e12e88
y.create.l HWIO_APPS_SMMU_CB3_PMEVTYPER2_APPS_ADDR A:0x61e13e88
y.create.l HWIO_APPS_SMMU_CB4_PMEVTYPER2_APPS_ADDR A:0x61e14e88
y.create.l HWIO_APPS_SMMU_CB5_PMEVTYPER2_APPS_ADDR A:0x61e15e88
y.create.l HWIO_APPS_SMMU_CB6_PMEVTYPER2_APPS_ADDR A:0x61e16e88
y.create.l HWIO_APPS_SMMU_CB7_PMEVTYPER2_APPS_ADDR A:0x61e17e88
y.create.l HWIO_APPS_SMMU_CB8_PMEVTYPER2_APPS_ADDR A:0x61e18e88
y.create.l HWIO_APPS_SMMU_CB9_PMEVTYPER2_APPS_ADDR A:0x61e19e88
y.create.l HWIO_APPS_SMMU_CB10_PMEVTYPER2_APPS_ADDR A:0x61e1ae88
y.create.l HWIO_APPS_SMMU_CB11_PMEVTYPER2_APPS_ADDR A:0x61e1be88
y.create.l HWIO_APPS_SMMU_CB12_PMEVTYPER2_APPS_ADDR A:0x61e1ce88
y.create.l HWIO_APPS_SMMU_CB13_PMEVTYPER2_APPS_ADDR A:0x61e1de88
y.create.l HWIO_APPS_SMMU_CB14_PMEVTYPER2_APPS_ADDR A:0x61e1ee88
y.create.l HWIO_APPS_SMMU_CB15_PMEVTYPER2_APPS_ADDR A:0x61e1fe88
y.create.l HWIO_APPS_SMMU_CB0_PMEVTYPER3_APPS_ADDR A:0x61e10e8c
y.create.l HWIO_APPS_SMMU_CB1_PMEVTYPER3_APPS_ADDR A:0x61e11e8c
y.create.l HWIO_APPS_SMMU_CB2_PMEVTYPER3_APPS_ADDR A:0x61e12e8c
y.create.l HWIO_APPS_SMMU_CB3_PMEVTYPER3_APPS_ADDR A:0x61e13e8c
y.create.l HWIO_APPS_SMMU_CB4_PMEVTYPER3_APPS_ADDR A:0x61e14e8c
y.create.l HWIO_APPS_SMMU_CB5_PMEVTYPER3_APPS_ADDR A:0x61e15e8c
y.create.l HWIO_APPS_SMMU_CB6_PMEVTYPER3_APPS_ADDR A:0x61e16e8c
y.create.l HWIO_APPS_SMMU_CB7_PMEVTYPER3_APPS_ADDR A:0x61e17e8c
y.create.l HWIO_APPS_SMMU_CB8_PMEVTYPER3_APPS_ADDR A:0x61e18e8c
y.create.l HWIO_APPS_SMMU_CB9_PMEVTYPER3_APPS_ADDR A:0x61e19e8c
y.create.l HWIO_APPS_SMMU_CB10_PMEVTYPER3_APPS_ADDR A:0x61e1ae8c
y.create.l HWIO_APPS_SMMU_CB11_PMEVTYPER3_APPS_ADDR A:0x61e1be8c
y.create.l HWIO_APPS_SMMU_CB12_PMEVTYPER3_APPS_ADDR A:0x61e1ce8c
y.create.l HWIO_APPS_SMMU_CB13_PMEVTYPER3_APPS_ADDR A:0x61e1de8c
y.create.l HWIO_APPS_SMMU_CB14_PMEVTYPER3_APPS_ADDR A:0x61e1ee8c
y.create.l HWIO_APPS_SMMU_CB15_PMEVTYPER3_APPS_ADDR A:0x61e1fe8c
y.create.l HWIO_APPS_SMMU_CB0_PMCFGR_APPS_ADDR A:0x61e10f00
y.create.l HWIO_APPS_SMMU_CB1_PMCFGR_APPS_ADDR A:0x61e11f00
y.create.l HWIO_APPS_SMMU_CB2_PMCFGR_APPS_ADDR A:0x61e12f00
y.create.l HWIO_APPS_SMMU_CB3_PMCFGR_APPS_ADDR A:0x61e13f00
y.create.l HWIO_APPS_SMMU_CB4_PMCFGR_APPS_ADDR A:0x61e14f00
y.create.l HWIO_APPS_SMMU_CB5_PMCFGR_APPS_ADDR A:0x61e15f00
y.create.l HWIO_APPS_SMMU_CB6_PMCFGR_APPS_ADDR A:0x61e16f00
y.create.l HWIO_APPS_SMMU_CB7_PMCFGR_APPS_ADDR A:0x61e17f00
y.create.l HWIO_APPS_SMMU_CB8_PMCFGR_APPS_ADDR A:0x61e18f00
y.create.l HWIO_APPS_SMMU_CB9_PMCFGR_APPS_ADDR A:0x61e19f00
y.create.l HWIO_APPS_SMMU_CB10_PMCFGR_APPS_ADDR A:0x61e1af00
y.create.l HWIO_APPS_SMMU_CB11_PMCFGR_APPS_ADDR A:0x61e1bf00
y.create.l HWIO_APPS_SMMU_CB12_PMCFGR_APPS_ADDR A:0x61e1cf00
y.create.l HWIO_APPS_SMMU_CB13_PMCFGR_APPS_ADDR A:0x61e1df00
y.create.l HWIO_APPS_SMMU_CB14_PMCFGR_APPS_ADDR A:0x61e1ef00
y.create.l HWIO_APPS_SMMU_CB15_PMCFGR_APPS_ADDR A:0x61e1ff00
y.create.l HWIO_APPS_SMMU_CB0_PMCR_APPS_ADDR A:0x61e10f04
y.create.l HWIO_APPS_SMMU_CB1_PMCR_APPS_ADDR A:0x61e11f04
y.create.l HWIO_APPS_SMMU_CB2_PMCR_APPS_ADDR A:0x61e12f04
y.create.l HWIO_APPS_SMMU_CB3_PMCR_APPS_ADDR A:0x61e13f04
y.create.l HWIO_APPS_SMMU_CB4_PMCR_APPS_ADDR A:0x61e14f04
y.create.l HWIO_APPS_SMMU_CB5_PMCR_APPS_ADDR A:0x61e15f04
y.create.l HWIO_APPS_SMMU_CB6_PMCR_APPS_ADDR A:0x61e16f04
y.create.l HWIO_APPS_SMMU_CB7_PMCR_APPS_ADDR A:0x61e17f04
y.create.l HWIO_APPS_SMMU_CB8_PMCR_APPS_ADDR A:0x61e18f04
y.create.l HWIO_APPS_SMMU_CB9_PMCR_APPS_ADDR A:0x61e19f04
y.create.l HWIO_APPS_SMMU_CB10_PMCR_APPS_ADDR A:0x61e1af04
y.create.l HWIO_APPS_SMMU_CB11_PMCR_APPS_ADDR A:0x61e1bf04
y.create.l HWIO_APPS_SMMU_CB12_PMCR_APPS_ADDR A:0x61e1cf04
y.create.l HWIO_APPS_SMMU_CB13_PMCR_APPS_ADDR A:0x61e1df04
y.create.l HWIO_APPS_SMMU_CB14_PMCR_APPS_ADDR A:0x61e1ef04
y.create.l HWIO_APPS_SMMU_CB15_PMCR_APPS_ADDR A:0x61e1ff04
y.create.l HWIO_APPS_SMMU_CB0_PMCEID_APPS_ADDR A:0x61e10f20
y.create.l HWIO_APPS_SMMU_CB1_PMCEID_APPS_ADDR A:0x61e11f20
y.create.l HWIO_APPS_SMMU_CB2_PMCEID_APPS_ADDR A:0x61e12f20
y.create.l HWIO_APPS_SMMU_CB3_PMCEID_APPS_ADDR A:0x61e13f20
y.create.l HWIO_APPS_SMMU_CB4_PMCEID_APPS_ADDR A:0x61e14f20
y.create.l HWIO_APPS_SMMU_CB5_PMCEID_APPS_ADDR A:0x61e15f20
y.create.l HWIO_APPS_SMMU_CB6_PMCEID_APPS_ADDR A:0x61e16f20
y.create.l HWIO_APPS_SMMU_CB7_PMCEID_APPS_ADDR A:0x61e17f20
y.create.l HWIO_APPS_SMMU_CB8_PMCEID_APPS_ADDR A:0x61e18f20
y.create.l HWIO_APPS_SMMU_CB9_PMCEID_APPS_ADDR A:0x61e19f20
y.create.l HWIO_APPS_SMMU_CB10_PMCEID_APPS_ADDR A:0x61e1af20
y.create.l HWIO_APPS_SMMU_CB11_PMCEID_APPS_ADDR A:0x61e1bf20
y.create.l HWIO_APPS_SMMU_CB12_PMCEID_APPS_ADDR A:0x61e1cf20
y.create.l HWIO_APPS_SMMU_CB13_PMCEID_APPS_ADDR A:0x61e1df20
y.create.l HWIO_APPS_SMMU_CB14_PMCEID_APPS_ADDR A:0x61e1ef20
y.create.l HWIO_APPS_SMMU_CB15_PMCEID_APPS_ADDR A:0x61e1ff20
y.create.l HWIO_APPS_SMMU_CB0_PMCNTENSE_APPS_ADDR A:0x61e10f40
y.create.l HWIO_APPS_SMMU_CB1_PMCNTENSE_APPS_ADDR A:0x61e11f40
y.create.l HWIO_APPS_SMMU_CB2_PMCNTENSE_APPS_ADDR A:0x61e12f40
y.create.l HWIO_APPS_SMMU_CB3_PMCNTENSE_APPS_ADDR A:0x61e13f40
y.create.l HWIO_APPS_SMMU_CB4_PMCNTENSE_APPS_ADDR A:0x61e14f40
y.create.l HWIO_APPS_SMMU_CB5_PMCNTENSE_APPS_ADDR A:0x61e15f40
y.create.l HWIO_APPS_SMMU_CB6_PMCNTENSE_APPS_ADDR A:0x61e16f40
y.create.l HWIO_APPS_SMMU_CB7_PMCNTENSE_APPS_ADDR A:0x61e17f40
y.create.l HWIO_APPS_SMMU_CB8_PMCNTENSE_APPS_ADDR A:0x61e18f40
y.create.l HWIO_APPS_SMMU_CB9_PMCNTENSE_APPS_ADDR A:0x61e19f40
y.create.l HWIO_APPS_SMMU_CB10_PMCNTENSE_APPS_ADDR A:0x61e1af40
y.create.l HWIO_APPS_SMMU_CB11_PMCNTENSE_APPS_ADDR A:0x61e1bf40
y.create.l HWIO_APPS_SMMU_CB12_PMCNTENSE_APPS_ADDR A:0x61e1cf40
y.create.l HWIO_APPS_SMMU_CB13_PMCNTENSE_APPS_ADDR A:0x61e1df40
y.create.l HWIO_APPS_SMMU_CB14_PMCNTENSE_APPS_ADDR A:0x61e1ef40
y.create.l HWIO_APPS_SMMU_CB15_PMCNTENSE_APPS_ADDR A:0x61e1ff40
y.create.l HWIO_APPS_SMMU_CB0_PMCNTENCLR_APPS_ADDR A:0x61e10f44
y.create.l HWIO_APPS_SMMU_CB1_PMCNTENCLR_APPS_ADDR A:0x61e11f44
y.create.l HWIO_APPS_SMMU_CB2_PMCNTENCLR_APPS_ADDR A:0x61e12f44
y.create.l HWIO_APPS_SMMU_CB3_PMCNTENCLR_APPS_ADDR A:0x61e13f44
y.create.l HWIO_APPS_SMMU_CB4_PMCNTENCLR_APPS_ADDR A:0x61e14f44
y.create.l HWIO_APPS_SMMU_CB5_PMCNTENCLR_APPS_ADDR A:0x61e15f44
y.create.l HWIO_APPS_SMMU_CB6_PMCNTENCLR_APPS_ADDR A:0x61e16f44
y.create.l HWIO_APPS_SMMU_CB7_PMCNTENCLR_APPS_ADDR A:0x61e17f44
y.create.l HWIO_APPS_SMMU_CB8_PMCNTENCLR_APPS_ADDR A:0x61e18f44
y.create.l HWIO_APPS_SMMU_CB9_PMCNTENCLR_APPS_ADDR A:0x61e19f44
y.create.l HWIO_APPS_SMMU_CB10_PMCNTENCLR_APPS_ADDR A:0x61e1af44
y.create.l HWIO_APPS_SMMU_CB11_PMCNTENCLR_APPS_ADDR A:0x61e1bf44
y.create.l HWIO_APPS_SMMU_CB12_PMCNTENCLR_APPS_ADDR A:0x61e1cf44
y.create.l HWIO_APPS_SMMU_CB13_PMCNTENCLR_APPS_ADDR A:0x61e1df44
y.create.l HWIO_APPS_SMMU_CB14_PMCNTENCLR_APPS_ADDR A:0x61e1ef44
y.create.l HWIO_APPS_SMMU_CB15_PMCNTENCLR_APPS_ADDR A:0x61e1ff44
y.create.l HWIO_APPS_SMMU_CB0_PMCNTENSET_APPS_ADDR A:0x61e10f48
y.create.l HWIO_APPS_SMMU_CB1_PMCNTENSET_APPS_ADDR A:0x61e11f48
y.create.l HWIO_APPS_SMMU_CB2_PMCNTENSET_APPS_ADDR A:0x61e12f48
y.create.l HWIO_APPS_SMMU_CB3_PMCNTENSET_APPS_ADDR A:0x61e13f48
y.create.l HWIO_APPS_SMMU_CB4_PMCNTENSET_APPS_ADDR A:0x61e14f48
y.create.l HWIO_APPS_SMMU_CB5_PMCNTENSET_APPS_ADDR A:0x61e15f48
y.create.l HWIO_APPS_SMMU_CB6_PMCNTENSET_APPS_ADDR A:0x61e16f48
y.create.l HWIO_APPS_SMMU_CB7_PMCNTENSET_APPS_ADDR A:0x61e17f48
y.create.l HWIO_APPS_SMMU_CB8_PMCNTENSET_APPS_ADDR A:0x61e18f48
y.create.l HWIO_APPS_SMMU_CB9_PMCNTENSET_APPS_ADDR A:0x61e19f48
y.create.l HWIO_APPS_SMMU_CB10_PMCNTENSET_APPS_ADDR A:0x61e1af48
y.create.l HWIO_APPS_SMMU_CB11_PMCNTENSET_APPS_ADDR A:0x61e1bf48
y.create.l HWIO_APPS_SMMU_CB12_PMCNTENSET_APPS_ADDR A:0x61e1cf48
y.create.l HWIO_APPS_SMMU_CB13_PMCNTENSET_APPS_ADDR A:0x61e1df48
y.create.l HWIO_APPS_SMMU_CB14_PMCNTENSET_APPS_ADDR A:0x61e1ef48
y.create.l HWIO_APPS_SMMU_CB15_PMCNTENSET_APPS_ADDR A:0x61e1ff48
y.create.l HWIO_APPS_SMMU_CB0_PMINTENCLR_APPS_ADDR A:0x61e10f4c
y.create.l HWIO_APPS_SMMU_CB1_PMINTENCLR_APPS_ADDR A:0x61e11f4c
y.create.l HWIO_APPS_SMMU_CB2_PMINTENCLR_APPS_ADDR A:0x61e12f4c
y.create.l HWIO_APPS_SMMU_CB3_PMINTENCLR_APPS_ADDR A:0x61e13f4c
y.create.l HWIO_APPS_SMMU_CB4_PMINTENCLR_APPS_ADDR A:0x61e14f4c
y.create.l HWIO_APPS_SMMU_CB5_PMINTENCLR_APPS_ADDR A:0x61e15f4c
y.create.l HWIO_APPS_SMMU_CB6_PMINTENCLR_APPS_ADDR A:0x61e16f4c
y.create.l HWIO_APPS_SMMU_CB7_PMINTENCLR_APPS_ADDR A:0x61e17f4c
y.create.l HWIO_APPS_SMMU_CB8_PMINTENCLR_APPS_ADDR A:0x61e18f4c
y.create.l HWIO_APPS_SMMU_CB9_PMINTENCLR_APPS_ADDR A:0x61e19f4c
y.create.l HWIO_APPS_SMMU_CB10_PMINTENCLR_APPS_ADDR A:0x61e1af4c
y.create.l HWIO_APPS_SMMU_CB11_PMINTENCLR_APPS_ADDR A:0x61e1bf4c
y.create.l HWIO_APPS_SMMU_CB12_PMINTENCLR_APPS_ADDR A:0x61e1cf4c
y.create.l HWIO_APPS_SMMU_CB13_PMINTENCLR_APPS_ADDR A:0x61e1df4c
y.create.l HWIO_APPS_SMMU_CB14_PMINTENCLR_APPS_ADDR A:0x61e1ef4c
y.create.l HWIO_APPS_SMMU_CB15_PMINTENCLR_APPS_ADDR A:0x61e1ff4c
y.create.l HWIO_APPS_SMMU_CB0_PMOVSCLR_APPS_ADDR A:0x61e10f50
y.create.l HWIO_APPS_SMMU_CB1_PMOVSCLR_APPS_ADDR A:0x61e11f50
y.create.l HWIO_APPS_SMMU_CB2_PMOVSCLR_APPS_ADDR A:0x61e12f50
y.create.l HWIO_APPS_SMMU_CB3_PMOVSCLR_APPS_ADDR A:0x61e13f50
y.create.l HWIO_APPS_SMMU_CB4_PMOVSCLR_APPS_ADDR A:0x61e14f50
y.create.l HWIO_APPS_SMMU_CB5_PMOVSCLR_APPS_ADDR A:0x61e15f50
y.create.l HWIO_APPS_SMMU_CB6_PMOVSCLR_APPS_ADDR A:0x61e16f50
y.create.l HWIO_APPS_SMMU_CB7_PMOVSCLR_APPS_ADDR A:0x61e17f50
y.create.l HWIO_APPS_SMMU_CB8_PMOVSCLR_APPS_ADDR A:0x61e18f50
y.create.l HWIO_APPS_SMMU_CB9_PMOVSCLR_APPS_ADDR A:0x61e19f50
y.create.l HWIO_APPS_SMMU_CB10_PMOVSCLR_APPS_ADDR A:0x61e1af50
y.create.l HWIO_APPS_SMMU_CB11_PMOVSCLR_APPS_ADDR A:0x61e1bf50
y.create.l HWIO_APPS_SMMU_CB12_PMOVSCLR_APPS_ADDR A:0x61e1cf50
y.create.l HWIO_APPS_SMMU_CB13_PMOVSCLR_APPS_ADDR A:0x61e1df50
y.create.l HWIO_APPS_SMMU_CB14_PMOVSCLR_APPS_ADDR A:0x61e1ef50
y.create.l HWIO_APPS_SMMU_CB15_PMOVSCLR_APPS_ADDR A:0x61e1ff50
y.create.l HWIO_APPS_SMMU_CB0_PMOVSSET_APPS_ADDR A:0x61e10f58
y.create.l HWIO_APPS_SMMU_CB1_PMOVSSET_APPS_ADDR A:0x61e11f58
y.create.l HWIO_APPS_SMMU_CB2_PMOVSSET_APPS_ADDR A:0x61e12f58
y.create.l HWIO_APPS_SMMU_CB3_PMOVSSET_APPS_ADDR A:0x61e13f58
y.create.l HWIO_APPS_SMMU_CB4_PMOVSSET_APPS_ADDR A:0x61e14f58
y.create.l HWIO_APPS_SMMU_CB5_PMOVSSET_APPS_ADDR A:0x61e15f58
y.create.l HWIO_APPS_SMMU_CB6_PMOVSSET_APPS_ADDR A:0x61e16f58
y.create.l HWIO_APPS_SMMU_CB7_PMOVSSET_APPS_ADDR A:0x61e17f58
y.create.l HWIO_APPS_SMMU_CB8_PMOVSSET_APPS_ADDR A:0x61e18f58
y.create.l HWIO_APPS_SMMU_CB9_PMOVSSET_APPS_ADDR A:0x61e19f58
y.create.l HWIO_APPS_SMMU_CB10_PMOVSSET_APPS_ADDR A:0x61e1af58
y.create.l HWIO_APPS_SMMU_CB11_PMOVSSET_APPS_ADDR A:0x61e1bf58
y.create.l HWIO_APPS_SMMU_CB12_PMOVSSET_APPS_ADDR A:0x61e1cf58
y.create.l HWIO_APPS_SMMU_CB13_PMOVSSET_APPS_ADDR A:0x61e1df58
y.create.l HWIO_APPS_SMMU_CB14_PMOVSSET_APPS_ADDR A:0x61e1ef58
y.create.l HWIO_APPS_SMMU_CB15_PMOVSSET_APPS_ADDR A:0x61e1ff58
y.create.l HWIO_APPS_SMMU_CB0_PMAUTHSTATUS_APPS_ADDR A:0x61e10fb8
y.create.l HWIO_APPS_SMMU_CB1_PMAUTHSTATUS_APPS_ADDR A:0x61e11fb8
y.create.l HWIO_APPS_SMMU_CB2_PMAUTHSTATUS_APPS_ADDR A:0x61e12fb8
y.create.l HWIO_APPS_SMMU_CB3_PMAUTHSTATUS_APPS_ADDR A:0x61e13fb8
y.create.l HWIO_APPS_SMMU_CB4_PMAUTHSTATUS_APPS_ADDR A:0x61e14fb8
y.create.l HWIO_APPS_SMMU_CB5_PMAUTHSTATUS_APPS_ADDR A:0x61e15fb8
y.create.l HWIO_APPS_SMMU_CB6_PMAUTHSTATUS_APPS_ADDR A:0x61e16fb8
y.create.l HWIO_APPS_SMMU_CB7_PMAUTHSTATUS_APPS_ADDR A:0x61e17fb8
y.create.l HWIO_APPS_SMMU_CB8_PMAUTHSTATUS_APPS_ADDR A:0x61e18fb8
y.create.l HWIO_APPS_SMMU_CB9_PMAUTHSTATUS_APPS_ADDR A:0x61e19fb8
y.create.l HWIO_APPS_SMMU_CB10_PMAUTHSTATUS_APPS_ADDR A:0x61e1afb8
y.create.l HWIO_APPS_SMMU_CB11_PMAUTHSTATUS_APPS_ADDR A:0x61e1bfb8
y.create.l HWIO_APPS_SMMU_CB12_PMAUTHSTATUS_APPS_ADDR A:0x61e1cfb8
y.create.l HWIO_APPS_SMMU_CB13_PMAUTHSTATUS_APPS_ADDR A:0x61e1dfb8
y.create.l HWIO_APPS_SMMU_CB14_PMAUTHSTATUS_APPS_ADDR A:0x61e1efb8
y.create.l HWIO_APPS_SMMU_CB15_PMAUTHSTATUS_APPS_ADDR A:0x61e1ffb8
y.create.l HWIO_APPS_SMMU_CR0_APPS_ADDR A:0x61e00000
y.create.l HWIO_APPS_SMMU_ACR_APPS_ADDR A:0x61e00010
y.create.l HWIO_APPS_SMMU_IDR0_APPS_ADDR A:0x61e00020
y.create.l HWIO_APPS_SMMU_IDR1_APPS_ADDR A:0x61e00024
y.create.l HWIO_APPS_SMMU_IDR2_APPS_ADDR A:0x61e00028
y.create.l HWIO_APPS_SMMU_IDR7_APPS_ADDR A:0x61e0003c
y.create.l HWIO_APPS_SMMU_GFAR_LOW_APPS_ADDR A:0x61e00040
y.create.l HWIO_APPS_SMMU_GFAR_HIGH_APPS_ADDR A:0x61e00044
y.create.l HWIO_APPS_SMMU_GFSR_APPS_ADDR A:0x61e00048
y.create.l HWIO_APPS_SMMU_GFSRRESTORE_APPS_ADDR A:0x61e0004c
y.create.l HWIO_APPS_SMMU_GFSYNR0_APPS_ADDR A:0x61e00050
y.create.l HWIO_APPS_SMMU_GFSYNR1_APPS_ADDR A:0x61e00054
y.create.l HWIO_APPS_SMMU_TLBIVMID_2_APPS_ADDR A:0x61e00064
y.create.l HWIO_APPS_SMMU_TLBIALLNSNH_2_APPS_ADDR A:0x61e00068
y.create.l HWIO_APPS_SMMU_TLBIALLH_APPS_ADDR A:0x61e0006c
y.create.l HWIO_APPS_SMMU_TLBGSYNC_APPS_ADDR A:0x61e00070
y.create.l HWIO_APPS_SMMU_TLBGSTATUS_APPS_ADDR A:0x61e00074
y.create.l HWIO_APPS_SMMU_TLBIVAH_LOW_APPS_ADDR A:0x61e00078
y.create.l HWIO_APPS_SMMU_TLBIVALH64_LOW_APPS_ADDR A:0x61e000b0
y.create.l HWIO_APPS_SMMU_TLBIVALH64_HIGH_APPS_ADDR A:0x61e000b4
y.create.l HWIO_APPS_SMMU_TLBIVMIDS1_APPS_ADDR A:0x61e000b8
y.create.l HWIO_APPS_SMMU_TLBIVAH64_LOW_APPS_ADDR A:0x61e000c0
y.create.l HWIO_APPS_SMMU_TLBIVAH64_HIGH_APPS_ADDR A:0x61e000c4
y.create.l HWIO_APPS_SMMU_SMR0_2_APPS_ADDR A:0x61e00800
y.create.l HWIO_APPS_SMMU_SMR1_2_APPS_ADDR A:0x61e00804
y.create.l HWIO_APPS_SMMU_SMR2_2_APPS_ADDR A:0x61e00808
y.create.l HWIO_APPS_SMMU_SMR3_2_APPS_ADDR A:0x61e0080c
y.create.l HWIO_APPS_SMMU_SMR4_2_APPS_ADDR A:0x61e00810
y.create.l HWIO_APPS_SMMU_SMR5_2_APPS_ADDR A:0x61e00814
y.create.l HWIO_APPS_SMMU_SMR6_2_APPS_ADDR A:0x61e00818
y.create.l HWIO_APPS_SMMU_SMR7_2_APPS_ADDR A:0x61e0081c
y.create.l HWIO_APPS_SMMU_SMR8_2_APPS_ADDR A:0x61e00820
y.create.l HWIO_APPS_SMMU_SMR9_2_APPS_ADDR A:0x61e00824
y.create.l HWIO_APPS_SMMU_SMR10_2_APPS_ADDR A:0x61e00828
y.create.l HWIO_APPS_SMMU_SMR11_2_APPS_ADDR A:0x61e0082c
y.create.l HWIO_APPS_SMMU_SMR12_2_APPS_ADDR A:0x61e00830
y.create.l HWIO_APPS_SMMU_SMR13_2_APPS_ADDR A:0x61e00834
y.create.l HWIO_APPS_SMMU_SMR14_2_APPS_ADDR A:0x61e00838
y.create.l HWIO_APPS_SMMU_SMR15_2_APPS_ADDR A:0x61e0083c
y.create.l HWIO_APPS_SMMU_SMR16_2_APPS_ADDR A:0x61e00840
y.create.l HWIO_APPS_SMMU_SMR17_2_APPS_ADDR A:0x61e00844
y.create.l HWIO_APPS_SMMU_SMR18_2_APPS_ADDR A:0x61e00848
y.create.l HWIO_APPS_SMMU_SMR19_2_APPS_ADDR A:0x61e0084c
y.create.l HWIO_APPS_SMMU_SMR20_2_APPS_ADDR A:0x61e00850
y.create.l HWIO_APPS_SMMU_SMR21_2_APPS_ADDR A:0x61e00854
y.create.l HWIO_APPS_SMMU_SMR22_2_APPS_ADDR A:0x61e00858
y.create.l HWIO_APPS_SMMU_SMR23_2_APPS_ADDR A:0x61e0085c
y.create.l HWIO_APPS_SMMU_SMR24_2_APPS_ADDR A:0x61e00860
y.create.l HWIO_APPS_SMMU_SMR25_2_APPS_ADDR A:0x61e00864
y.create.l HWIO_APPS_SMMU_SMR26_2_APPS_ADDR A:0x61e00868
y.create.l HWIO_APPS_SMMU_SMR27_2_APPS_ADDR A:0x61e0086c
y.create.l HWIO_APPS_SMMU_SMR28_2_APPS_ADDR A:0x61e00870
y.create.l HWIO_APPS_SMMU_SMR29_2_APPS_ADDR A:0x61e00874
y.create.l HWIO_APPS_SMMU_SMR30_2_APPS_ADDR A:0x61e00878
y.create.l HWIO_APPS_SMMU_SMR31_2_APPS_ADDR A:0x61e0087c
y.create.l HWIO_APPS_SMMU_S2CR0_2_APPS_ADDR A:0x61e00c00
y.create.l HWIO_APPS_SMMU_S2CR1_2_APPS_ADDR A:0x61e00c04
y.create.l HWIO_APPS_SMMU_S2CR2_2_APPS_ADDR A:0x61e00c08
y.create.l HWIO_APPS_SMMU_S2CR3_2_APPS_ADDR A:0x61e00c0c
y.create.l HWIO_APPS_SMMU_S2CR4_2_APPS_ADDR A:0x61e00c10
y.create.l HWIO_APPS_SMMU_S2CR5_2_APPS_ADDR A:0x61e00c14
y.create.l HWIO_APPS_SMMU_S2CR6_2_APPS_ADDR A:0x61e00c18
y.create.l HWIO_APPS_SMMU_S2CR7_2_APPS_ADDR A:0x61e00c1c
y.create.l HWIO_APPS_SMMU_S2CR8_2_APPS_ADDR A:0x61e00c20
y.create.l HWIO_APPS_SMMU_S2CR9_2_APPS_ADDR A:0x61e00c24
y.create.l HWIO_APPS_SMMU_S2CR10_2_APPS_ADDR A:0x61e00c28
y.create.l HWIO_APPS_SMMU_S2CR11_2_APPS_ADDR A:0x61e00c2c
y.create.l HWIO_APPS_SMMU_S2CR12_2_APPS_ADDR A:0x61e00c30
y.create.l HWIO_APPS_SMMU_S2CR13_2_APPS_ADDR A:0x61e00c34
y.create.l HWIO_APPS_SMMU_S2CR14_2_APPS_ADDR A:0x61e00c38
y.create.l HWIO_APPS_SMMU_S2CR15_2_APPS_ADDR A:0x61e00c3c
y.create.l HWIO_APPS_SMMU_S2CR16_2_APPS_ADDR A:0x61e00c40
y.create.l HWIO_APPS_SMMU_S2CR17_2_APPS_ADDR A:0x61e00c44
y.create.l HWIO_APPS_SMMU_S2CR18_2_APPS_ADDR A:0x61e00c48
y.create.l HWIO_APPS_SMMU_S2CR19_2_APPS_ADDR A:0x61e00c4c
y.create.l HWIO_APPS_SMMU_S2CR20_2_APPS_ADDR A:0x61e00c50
y.create.l HWIO_APPS_SMMU_S2CR21_2_APPS_ADDR A:0x61e00c54
y.create.l HWIO_APPS_SMMU_S2CR22_2_APPS_ADDR A:0x61e00c58
y.create.l HWIO_APPS_SMMU_S2CR23_2_APPS_ADDR A:0x61e00c5c
y.create.l HWIO_APPS_SMMU_S2CR24_2_APPS_ADDR A:0x61e00c60
y.create.l HWIO_APPS_SMMU_S2CR25_2_APPS_ADDR A:0x61e00c64
y.create.l HWIO_APPS_SMMU_S2CR26_2_APPS_ADDR A:0x61e00c68
y.create.l HWIO_APPS_SMMU_S2CR27_2_APPS_ADDR A:0x61e00c6c
y.create.l HWIO_APPS_SMMU_S2CR28_2_APPS_ADDR A:0x61e00c70
y.create.l HWIO_APPS_SMMU_S2CR29_2_APPS_ADDR A:0x61e00c74
y.create.l HWIO_APPS_SMMU_S2CR30_2_APPS_ADDR A:0x61e00c78
y.create.l HWIO_APPS_SMMU_S2CR31_2_APPS_ADDR A:0x61e00c7c
y.create.l HWIO_APPS_SMMU_PIDR0_2_APPS_ADDR A:0x61e00fe0
y.create.l HWIO_APPS_SMMU_PIDR1_2_APPS_ADDR A:0x61e00fe4
y.create.l HWIO_APPS_SMMU_PIDR2_2_APPS_ADDR A:0x61e00fe8
y.create.l HWIO_APPS_SMMU_PIDR3_2_APPS_ADDR A:0x61e00fec
y.create.l HWIO_APPS_SMMU_PIDR4_2_APPS_ADDR A:0x61e00fd0
y.create.l HWIO_APPS_SMMU_PIDR5_2_APPS_ADDR A:0x61e00fd4
y.create.l HWIO_APPS_SMMU_PIDR6_2_APPS_ADDR A:0x61e00fd8
y.create.l HWIO_APPS_SMMU_PIDR7_2_APPS_ADDR A:0x61e00fdc
y.create.l HWIO_APPS_SMMU_CIDR0_2_APPS_ADDR A:0x61e00ff0
y.create.l HWIO_APPS_SMMU_CIDR1_2_APPS_ADDR A:0x61e00ff4
y.create.l HWIO_APPS_SMMU_CIDR2_2_APPS_ADDR A:0x61e00ff8
y.create.l HWIO_APPS_SMMU_CIDR3_2_APPS_ADDR A:0x61e00ffc
y.create.l HWIO_APPS_SMMU_CBAR0_2_APPS_ADDR A:0x61e01000
y.create.l HWIO_APPS_SMMU_CBFRSYNRA0_2_APPS_ADDR A:0x61e01400
y.create.l HWIO_APPS_SMMU_CBA2R0_2_APPS_ADDR A:0x61e01800
y.create.l HWIO_APPS_SMMU_CBAR1_2_APPS_ADDR A:0x61e01004
y.create.l HWIO_APPS_SMMU_CBFRSYNRA1_2_APPS_ADDR A:0x61e01404
y.create.l HWIO_APPS_SMMU_CBA2R1_2_APPS_ADDR A:0x61e01804
y.create.l HWIO_APPS_SMMU_CBAR2_2_APPS_ADDR A:0x61e01008
y.create.l HWIO_APPS_SMMU_CBFRSYNRA2_2_APPS_ADDR A:0x61e01408
y.create.l HWIO_APPS_SMMU_CBA2R2_2_APPS_ADDR A:0x61e01808
y.create.l HWIO_APPS_SMMU_CBAR3_2_APPS_ADDR A:0x61e0100c
y.create.l HWIO_APPS_SMMU_CBFRSYNRA3_2_APPS_ADDR A:0x61e0140c
y.create.l HWIO_APPS_SMMU_CBA2R3_2_APPS_ADDR A:0x61e0180c
y.create.l HWIO_APPS_SMMU_CBAR4_2_APPS_ADDR A:0x61e01010
y.create.l HWIO_APPS_SMMU_CBFRSYNRA4_2_APPS_ADDR A:0x61e01410
y.create.l HWIO_APPS_SMMU_CBA2R4_2_APPS_ADDR A:0x61e01810
y.create.l HWIO_APPS_SMMU_CBAR5_2_APPS_ADDR A:0x61e01014
y.create.l HWIO_APPS_SMMU_CBFRSYNRA5_2_APPS_ADDR A:0x61e01414
y.create.l HWIO_APPS_SMMU_CBA2R5_2_APPS_ADDR A:0x61e01814
y.create.l HWIO_APPS_SMMU_CBAR6_2_APPS_ADDR A:0x61e01018
y.create.l HWIO_APPS_SMMU_CBFRSYNRA6_2_APPS_ADDR A:0x61e01418
y.create.l HWIO_APPS_SMMU_CBA2R6_2_APPS_ADDR A:0x61e01818
y.create.l HWIO_APPS_SMMU_CBAR7_2_APPS_ADDR A:0x61e0101c
y.create.l HWIO_APPS_SMMU_CBFRSYNRA7_2_APPS_ADDR A:0x61e0141c
y.create.l HWIO_APPS_SMMU_CBA2R7_2_APPS_ADDR A:0x61e0181c
y.create.l HWIO_APPS_SMMU_CBAR8_2_APPS_ADDR A:0x61e01020
y.create.l HWIO_APPS_SMMU_CBFRSYNRA8_2_APPS_ADDR A:0x61e01420
y.create.l HWIO_APPS_SMMU_CBA2R8_2_APPS_ADDR A:0x61e01820
y.create.l HWIO_APPS_SMMU_CBAR9_2_APPS_ADDR A:0x61e01024
y.create.l HWIO_APPS_SMMU_CBFRSYNRA9_2_APPS_ADDR A:0x61e01424
y.create.l HWIO_APPS_SMMU_CBA2R9_2_APPS_ADDR A:0x61e01824
y.create.l HWIO_APPS_SMMU_CBAR10_2_APPS_ADDR A:0x61e01028
y.create.l HWIO_APPS_SMMU_CBFRSYNRA10_2_APPS_ADDR A:0x61e01428
y.create.l HWIO_APPS_SMMU_CBA2R10_2_APPS_ADDR A:0x61e01828
y.create.l HWIO_APPS_SMMU_CBAR11_2_APPS_ADDR A:0x61e0102c
y.create.l HWIO_APPS_SMMU_CBFRSYNRA11_2_APPS_ADDR A:0x61e0142c
y.create.l HWIO_APPS_SMMU_CBA2R11_2_APPS_ADDR A:0x61e0182c
y.create.l HWIO_APPS_SMMU_CBAR12_2_APPS_ADDR A:0x61e01030
y.create.l HWIO_APPS_SMMU_CBFRSYNRA12_2_APPS_ADDR A:0x61e01430
y.create.l HWIO_APPS_SMMU_CBA2R12_2_APPS_ADDR A:0x61e01830
y.create.l HWIO_APPS_SMMU_CBAR13_2_APPS_ADDR A:0x61e01034
y.create.l HWIO_APPS_SMMU_CBFRSYNRA13_2_APPS_ADDR A:0x61e01434
y.create.l HWIO_APPS_SMMU_CBA2R13_2_APPS_ADDR A:0x61e01834
y.create.l HWIO_APPS_SMMU_CBAR14_2_APPS_ADDR A:0x61e01038
y.create.l HWIO_APPS_SMMU_CBFRSYNRA14_2_APPS_ADDR A:0x61e01438
y.create.l HWIO_APPS_SMMU_CBA2R14_2_APPS_ADDR A:0x61e01838
y.create.l HWIO_APPS_SMMU_CBAR15_2_APPS_ADDR A:0x61e0103c
y.create.l HWIO_APPS_SMMU_CBFRSYNRA15_2_APPS_ADDR A:0x61e0143c
y.create.l HWIO_APPS_SMMU_CBA2R15_2_APPS_ADDR A:0x61e0183c
y.create.l HWIO_APPS_PMEVCNTR0_2_APPS_ADDR A:0x61e03000
y.create.l HWIO_APPS_PMEVCNTR1_2_APPS_ADDR A:0x61e03004
y.create.l HWIO_APPS_PMEVCNTR2_2_APPS_ADDR A:0x61e03008
y.create.l HWIO_APPS_PMEVCNTR3_2_APPS_ADDR A:0x61e0300c
y.create.l HWIO_APPS_PMEVCNTR4_2_APPS_ADDR A:0x61e03010
y.create.l HWIO_APPS_PMEVCNTR5_2_APPS_ADDR A:0x61e03014
y.create.l HWIO_APPS_PMEVCNTR6_2_APPS_ADDR A:0x61e03018
y.create.l HWIO_APPS_PMEVCNTR7_2_APPS_ADDR A:0x61e0301c
y.create.l HWIO_APPS_PMEVCNTR8_2_APPS_ADDR A:0x61e03020
y.create.l HWIO_APPS_PMEVCNTR9_2_APPS_ADDR A:0x61e03024
y.create.l HWIO_APPS_PMEVCNTR10_2_APPS_ADDR A:0x61e03028
y.create.l HWIO_APPS_PMEVCNTR11_2_APPS_ADDR A:0x61e0302c
y.create.l HWIO_APPS_PMEVTYPER0_2_APPS_ADDR A:0x61e03400
y.create.l HWIO_APPS_PMEVTYPER1_2_APPS_ADDR A:0x61e03404
y.create.l HWIO_APPS_PMEVTYPER2_2_APPS_ADDR A:0x61e03408
y.create.l HWIO_APPS_PMEVTYPER3_2_APPS_ADDR A:0x61e0340c
y.create.l HWIO_APPS_PMEVTYPER4_2_APPS_ADDR A:0x61e03410
y.create.l HWIO_APPS_PMEVTYPER5_2_APPS_ADDR A:0x61e03414
y.create.l HWIO_APPS_PMEVTYPER6_2_APPS_ADDR A:0x61e03418
y.create.l HWIO_APPS_PMEVTYPER7_2_APPS_ADDR A:0x61e0341c
y.create.l HWIO_APPS_PMEVTYPER8_2_APPS_ADDR A:0x61e03420
y.create.l HWIO_APPS_PMEVTYPER9_2_APPS_ADDR A:0x61e03424
y.create.l HWIO_APPS_PMEVTYPER10_2_APPS_ADDR A:0x61e03428
y.create.l HWIO_APPS_PMEVTYPER11_2_APPS_ADDR A:0x61e0342c
y.create.l HWIO_APPS_PMCGCR0_2_APPS_ADDR A:0x61e03800
y.create.l HWIO_APPS_PMCGCR1_2_APPS_ADDR A:0x61e03804
y.create.l HWIO_APPS_PMCGCR2_2_APPS_ADDR A:0x61e03808
y.create.l HWIO_APPS_PMCGSMR0_2_APPS_ADDR A:0x61e03a00
y.create.l HWIO_APPS_PMCGSMR1_2_APPS_ADDR A:0x61e03a04
y.create.l HWIO_APPS_PMCGSMR2_2_APPS_ADDR A:0x61e03a08
y.create.l HWIO_APPS_PMCNTENSET_2_APPS_ADDR A:0x61e03c00
y.create.l HWIO_APPS_PMCNTENCLR_2_APPS_ADDR A:0x61e03c20
y.create.l HWIO_APPS_PMINTENSET_2_APPS_ADDR A:0x61e03c40
y.create.l HWIO_APPS_PMINTENCLR_2_APPS_ADDR A:0x61e03c60
y.create.l HWIO_APPS_PMOVSCLR_2_APPS_ADDR A:0x61e03c80
y.create.l HWIO_APPS_PMOVSSET_2_APPS_ADDR A:0x61e03cc0
y.create.l HWIO_APPS_PMCFGR_2_APPS_ADDR A:0x61e03e00
y.create.l HWIO_APPS_PMCR_2_APPS_ADDR A:0x61e03e04
y.create.l HWIO_APPS_PMCEID0_2_APPS_ADDR A:0x61e03e20
y.create.l HWIO_APPS_PMAUTHSTATUS_2_APPS_ADDR A:0x61e03fb8
y.create.l HWIO_APPS_PMDEVTYPE_2_APPS_ADDR A:0x61e03fcc
y.create.l HWIO_APPS_SMMU_CB0_SCTLR_2_APPS_ADDR A:0x61e10000
y.create.l HWIO_APPS_SMMU_CB1_SCTLR_2_APPS_ADDR A:0x61e11000
y.create.l HWIO_APPS_SMMU_CB2_SCTLR_2_APPS_ADDR A:0x61e12000
y.create.l HWIO_APPS_SMMU_CB3_SCTLR_2_APPS_ADDR A:0x61e13000
y.create.l HWIO_APPS_SMMU_CB4_SCTLR_2_APPS_ADDR A:0x61e14000
y.create.l HWIO_APPS_SMMU_CB5_SCTLR_2_APPS_ADDR A:0x61e15000
y.create.l HWIO_APPS_SMMU_CB6_SCTLR_2_APPS_ADDR A:0x61e16000
y.create.l HWIO_APPS_SMMU_CB7_SCTLR_2_APPS_ADDR A:0x61e17000
y.create.l HWIO_APPS_SMMU_CB8_SCTLR_2_APPS_ADDR A:0x61e18000
y.create.l HWIO_APPS_SMMU_CB9_SCTLR_2_APPS_ADDR A:0x61e19000
y.create.l HWIO_APPS_SMMU_CB10_SCTLR_2_APPS_ADDR A:0x61e1a000
y.create.l HWIO_APPS_SMMU_CB11_SCTLR_2_APPS_ADDR A:0x61e1b000
y.create.l HWIO_APPS_SMMU_CB12_SCTLR_2_APPS_ADDR A:0x61e1c000
y.create.l HWIO_APPS_SMMU_CB13_SCTLR_2_APPS_ADDR A:0x61e1d000
y.create.l HWIO_APPS_SMMU_CB14_SCTLR_2_APPS_ADDR A:0x61e1e000
y.create.l HWIO_APPS_SMMU_CB15_SCTLR_2_APPS_ADDR A:0x61e1f000
y.create.l HWIO_APPS_SMMU_CB0_ACTLR_2_APPS_ADDR A:0x61e10004
y.create.l HWIO_APPS_SMMU_CB1_ACTLR_2_APPS_ADDR A:0x61e11004
y.create.l HWIO_APPS_SMMU_CB2_ACTLR_2_APPS_ADDR A:0x61e12004
y.create.l HWIO_APPS_SMMU_CB3_ACTLR_2_APPS_ADDR A:0x61e13004
y.create.l HWIO_APPS_SMMU_CB4_ACTLR_2_APPS_ADDR A:0x61e14004
y.create.l HWIO_APPS_SMMU_CB5_ACTLR_2_APPS_ADDR A:0x61e15004
y.create.l HWIO_APPS_SMMU_CB6_ACTLR_2_APPS_ADDR A:0x61e16004
y.create.l HWIO_APPS_SMMU_CB7_ACTLR_2_APPS_ADDR A:0x61e17004
y.create.l HWIO_APPS_SMMU_CB8_ACTLR_2_APPS_ADDR A:0x61e18004
y.create.l HWIO_APPS_SMMU_CB9_ACTLR_2_APPS_ADDR A:0x61e19004
y.create.l HWIO_APPS_SMMU_CB10_ACTLR_2_APPS_ADDR A:0x61e1a004
y.create.l HWIO_APPS_SMMU_CB11_ACTLR_2_APPS_ADDR A:0x61e1b004
y.create.l HWIO_APPS_SMMU_CB12_ACTLR_2_APPS_ADDR A:0x61e1c004
y.create.l HWIO_APPS_SMMU_CB13_ACTLR_2_APPS_ADDR A:0x61e1d004
y.create.l HWIO_APPS_SMMU_CB14_ACTLR_2_APPS_ADDR A:0x61e1e004
y.create.l HWIO_APPS_SMMU_CB15_ACTLR_2_APPS_ADDR A:0x61e1f004
y.create.l HWIO_APPS_SMMU_CB0_RESUME_2_APPS_ADDR A:0x61e10008
y.create.l HWIO_APPS_SMMU_CB1_RESUME_2_APPS_ADDR A:0x61e11008
y.create.l HWIO_APPS_SMMU_CB2_RESUME_2_APPS_ADDR A:0x61e12008
y.create.l HWIO_APPS_SMMU_CB3_RESUME_2_APPS_ADDR A:0x61e13008
y.create.l HWIO_APPS_SMMU_CB4_RESUME_2_APPS_ADDR A:0x61e14008
y.create.l HWIO_APPS_SMMU_CB5_RESUME_2_APPS_ADDR A:0x61e15008
y.create.l HWIO_APPS_SMMU_CB6_RESUME_2_APPS_ADDR A:0x61e16008
y.create.l HWIO_APPS_SMMU_CB7_RESUME_2_APPS_ADDR A:0x61e17008
y.create.l HWIO_APPS_SMMU_CB8_RESUME_2_APPS_ADDR A:0x61e18008
y.create.l HWIO_APPS_SMMU_CB9_RESUME_2_APPS_ADDR A:0x61e19008
y.create.l HWIO_APPS_SMMU_CB10_RESUME_2_APPS_ADDR A:0x61e1a008
y.create.l HWIO_APPS_SMMU_CB11_RESUME_2_APPS_ADDR A:0x61e1b008
y.create.l HWIO_APPS_SMMU_CB12_RESUME_2_APPS_ADDR A:0x61e1c008
y.create.l HWIO_APPS_SMMU_CB13_RESUME_2_APPS_ADDR A:0x61e1d008
y.create.l HWIO_APPS_SMMU_CB14_RESUME_2_APPS_ADDR A:0x61e1e008
y.create.l HWIO_APPS_SMMU_CB15_RESUME_2_APPS_ADDR A:0x61e1f008
y.create.l HWIO_APPS_SMMU_CB0_TCR2_2_APPS_ADDR A:0x61e10010
y.create.l HWIO_APPS_SMMU_CB1_TCR2_2_APPS_ADDR A:0x61e11010
y.create.l HWIO_APPS_SMMU_CB2_TCR2_2_APPS_ADDR A:0x61e12010
y.create.l HWIO_APPS_SMMU_CB3_TCR2_2_APPS_ADDR A:0x61e13010
y.create.l HWIO_APPS_SMMU_CB4_TCR2_2_APPS_ADDR A:0x61e14010
y.create.l HWIO_APPS_SMMU_CB5_TCR2_2_APPS_ADDR A:0x61e15010
y.create.l HWIO_APPS_SMMU_CB6_TCR2_2_APPS_ADDR A:0x61e16010
y.create.l HWIO_APPS_SMMU_CB7_TCR2_2_APPS_ADDR A:0x61e17010
y.create.l HWIO_APPS_SMMU_CB8_TCR2_2_APPS_ADDR A:0x61e18010
y.create.l HWIO_APPS_SMMU_CB9_TCR2_2_APPS_ADDR A:0x61e19010
y.create.l HWIO_APPS_SMMU_CB10_TCR2_2_APPS_ADDR A:0x61e1a010
y.create.l HWIO_APPS_SMMU_CB11_TCR2_2_APPS_ADDR A:0x61e1b010
y.create.l HWIO_APPS_SMMU_CB12_TCR2_2_APPS_ADDR A:0x61e1c010
y.create.l HWIO_APPS_SMMU_CB13_TCR2_2_APPS_ADDR A:0x61e1d010
y.create.l HWIO_APPS_SMMU_CB14_TCR2_2_APPS_ADDR A:0x61e1e010
y.create.l HWIO_APPS_SMMU_CB15_TCR2_2_APPS_ADDR A:0x61e1f010
y.create.l HWIO_APPS_SMMU_CB0_TTBR0_LOW_2_APPS_ADDR A:0x61e10020
y.create.l HWIO_APPS_SMMU_CB1_TTBR0_LOW_2_APPS_ADDR A:0x61e11020
y.create.l HWIO_APPS_SMMU_CB2_TTBR0_LOW_2_APPS_ADDR A:0x61e12020
y.create.l HWIO_APPS_SMMU_CB3_TTBR0_LOW_2_APPS_ADDR A:0x61e13020
y.create.l HWIO_APPS_SMMU_CB4_TTBR0_LOW_2_APPS_ADDR A:0x61e14020
y.create.l HWIO_APPS_SMMU_CB5_TTBR0_LOW_2_APPS_ADDR A:0x61e15020
y.create.l HWIO_APPS_SMMU_CB6_TTBR0_LOW_2_APPS_ADDR A:0x61e16020
y.create.l HWIO_APPS_SMMU_CB7_TTBR0_LOW_2_APPS_ADDR A:0x61e17020
y.create.l HWIO_APPS_SMMU_CB8_TTBR0_LOW_2_APPS_ADDR A:0x61e18020
y.create.l HWIO_APPS_SMMU_CB9_TTBR0_LOW_2_APPS_ADDR A:0x61e19020
y.create.l HWIO_APPS_SMMU_CB10_TTBR0_LOW_2_APPS_ADDR A:0x61e1a020
y.create.l HWIO_APPS_SMMU_CB11_TTBR0_LOW_2_APPS_ADDR A:0x61e1b020
y.create.l HWIO_APPS_SMMU_CB12_TTBR0_LOW_2_APPS_ADDR A:0x61e1c020
y.create.l HWIO_APPS_SMMU_CB13_TTBR0_LOW_2_APPS_ADDR A:0x61e1d020
y.create.l HWIO_APPS_SMMU_CB14_TTBR0_LOW_2_APPS_ADDR A:0x61e1e020
y.create.l HWIO_APPS_SMMU_CB15_TTBR0_LOW_2_APPS_ADDR A:0x61e1f020
y.create.l HWIO_APPS_SMMU_CB0_TTBR0_HIGH_2_APPS_ADDR A:0x61e10024
y.create.l HWIO_APPS_SMMU_CB1_TTBR0_HIGH_2_APPS_ADDR A:0x61e11024
y.create.l HWIO_APPS_SMMU_CB2_TTBR0_HIGH_2_APPS_ADDR A:0x61e12024
y.create.l HWIO_APPS_SMMU_CB3_TTBR0_HIGH_2_APPS_ADDR A:0x61e13024
y.create.l HWIO_APPS_SMMU_CB4_TTBR0_HIGH_2_APPS_ADDR A:0x61e14024
y.create.l HWIO_APPS_SMMU_CB5_TTBR0_HIGH_2_APPS_ADDR A:0x61e15024
y.create.l HWIO_APPS_SMMU_CB6_TTBR0_HIGH_2_APPS_ADDR A:0x61e16024
y.create.l HWIO_APPS_SMMU_CB7_TTBR0_HIGH_2_APPS_ADDR A:0x61e17024
y.create.l HWIO_APPS_SMMU_CB8_TTBR0_HIGH_2_APPS_ADDR A:0x61e18024
y.create.l HWIO_APPS_SMMU_CB9_TTBR0_HIGH_2_APPS_ADDR A:0x61e19024
y.create.l HWIO_APPS_SMMU_CB10_TTBR0_HIGH_2_APPS_ADDR A:0x61e1a024
y.create.l HWIO_APPS_SMMU_CB11_TTBR0_HIGH_2_APPS_ADDR A:0x61e1b024
y.create.l HWIO_APPS_SMMU_CB12_TTBR0_HIGH_2_APPS_ADDR A:0x61e1c024
y.create.l HWIO_APPS_SMMU_CB13_TTBR0_HIGH_2_APPS_ADDR A:0x61e1d024
y.create.l HWIO_APPS_SMMU_CB14_TTBR0_HIGH_2_APPS_ADDR A:0x61e1e024
y.create.l HWIO_APPS_SMMU_CB15_TTBR0_HIGH_2_APPS_ADDR A:0x61e1f024
y.create.l HWIO_APPS_SMMU_CB0_TTBR1_LOW_2_APPS_ADDR A:0x61e10028
y.create.l HWIO_APPS_SMMU_CB1_TTBR1_LOW_2_APPS_ADDR A:0x61e11028
y.create.l HWIO_APPS_SMMU_CB2_TTBR1_LOW_2_APPS_ADDR A:0x61e12028
y.create.l HWIO_APPS_SMMU_CB3_TTBR1_LOW_2_APPS_ADDR A:0x61e13028
y.create.l HWIO_APPS_SMMU_CB4_TTBR1_LOW_2_APPS_ADDR A:0x61e14028
y.create.l HWIO_APPS_SMMU_CB5_TTBR1_LOW_2_APPS_ADDR A:0x61e15028
y.create.l HWIO_APPS_SMMU_CB6_TTBR1_LOW_2_APPS_ADDR A:0x61e16028
y.create.l HWIO_APPS_SMMU_CB7_TTBR1_LOW_2_APPS_ADDR A:0x61e17028
y.create.l HWIO_APPS_SMMU_CB8_TTBR1_LOW_2_APPS_ADDR A:0x61e18028
y.create.l HWIO_APPS_SMMU_CB9_TTBR1_LOW_2_APPS_ADDR A:0x61e19028
y.create.l HWIO_APPS_SMMU_CB10_TTBR1_LOW_2_APPS_ADDR A:0x61e1a028
y.create.l HWIO_APPS_SMMU_CB11_TTBR1_LOW_2_APPS_ADDR A:0x61e1b028
y.create.l HWIO_APPS_SMMU_CB12_TTBR1_LOW_2_APPS_ADDR A:0x61e1c028
y.create.l HWIO_APPS_SMMU_CB13_TTBR1_LOW_2_APPS_ADDR A:0x61e1d028
y.create.l HWIO_APPS_SMMU_CB14_TTBR1_LOW_2_APPS_ADDR A:0x61e1e028
y.create.l HWIO_APPS_SMMU_CB15_TTBR1_LOW_2_APPS_ADDR A:0x61e1f028
y.create.l HWIO_APPS_SMMU_CB0_TTBR1_HIGH_2_APPS_ADDR A:0x61e1002c
y.create.l HWIO_APPS_SMMU_CB1_TTBR1_HIGH_2_APPS_ADDR A:0x61e1102c
y.create.l HWIO_APPS_SMMU_CB2_TTBR1_HIGH_2_APPS_ADDR A:0x61e1202c
y.create.l HWIO_APPS_SMMU_CB3_TTBR1_HIGH_2_APPS_ADDR A:0x61e1302c
y.create.l HWIO_APPS_SMMU_CB4_TTBR1_HIGH_2_APPS_ADDR A:0x61e1402c
y.create.l HWIO_APPS_SMMU_CB5_TTBR1_HIGH_2_APPS_ADDR A:0x61e1502c
y.create.l HWIO_APPS_SMMU_CB6_TTBR1_HIGH_2_APPS_ADDR A:0x61e1602c
y.create.l HWIO_APPS_SMMU_CB7_TTBR1_HIGH_2_APPS_ADDR A:0x61e1702c
y.create.l HWIO_APPS_SMMU_CB8_TTBR1_HIGH_2_APPS_ADDR A:0x61e1802c
y.create.l HWIO_APPS_SMMU_CB9_TTBR1_HIGH_2_APPS_ADDR A:0x61e1902c
y.create.l HWIO_APPS_SMMU_CB10_TTBR1_HIGH_2_APPS_ADDR A:0x61e1a02c
y.create.l HWIO_APPS_SMMU_CB11_TTBR1_HIGH_2_APPS_ADDR A:0x61e1b02c
y.create.l HWIO_APPS_SMMU_CB12_TTBR1_HIGH_2_APPS_ADDR A:0x61e1c02c
y.create.l HWIO_APPS_SMMU_CB13_TTBR1_HIGH_2_APPS_ADDR A:0x61e1d02c
y.create.l HWIO_APPS_SMMU_CB14_TTBR1_HIGH_2_APPS_ADDR A:0x61e1e02c
y.create.l HWIO_APPS_SMMU_CB15_TTBR1_HIGH_2_APPS_ADDR A:0x61e1f02c
y.create.l HWIO_APPS_SMMU_CB0_TCR_LPAE_2_APPS_ADDR A:0x61e10030
y.create.l HWIO_APPS_SMMU_CB1_TCR_LPAE_2_APPS_ADDR A:0x61e11030
y.create.l HWIO_APPS_SMMU_CB2_TCR_LPAE_2_APPS_ADDR A:0x61e12030
y.create.l HWIO_APPS_SMMU_CB3_TCR_LPAE_2_APPS_ADDR A:0x61e13030
y.create.l HWIO_APPS_SMMU_CB4_TCR_LPAE_2_APPS_ADDR A:0x61e14030
y.create.l HWIO_APPS_SMMU_CB5_TCR_LPAE_2_APPS_ADDR A:0x61e15030
y.create.l HWIO_APPS_SMMU_CB6_TCR_LPAE_2_APPS_ADDR A:0x61e16030
y.create.l HWIO_APPS_SMMU_CB7_TCR_LPAE_2_APPS_ADDR A:0x61e17030
y.create.l HWIO_APPS_SMMU_CB8_TCR_LPAE_2_APPS_ADDR A:0x61e18030
y.create.l HWIO_APPS_SMMU_CB9_TCR_LPAE_2_APPS_ADDR A:0x61e19030
y.create.l HWIO_APPS_SMMU_CB10_TCR_LPAE_2_APPS_ADDR A:0x61e1a030
y.create.l HWIO_APPS_SMMU_CB11_TCR_LPAE_2_APPS_ADDR A:0x61e1b030
y.create.l HWIO_APPS_SMMU_CB12_TCR_LPAE_2_APPS_ADDR A:0x61e1c030
y.create.l HWIO_APPS_SMMU_CB13_TCR_LPAE_2_APPS_ADDR A:0x61e1d030
y.create.l HWIO_APPS_SMMU_CB14_TCR_LPAE_2_APPS_ADDR A:0x61e1e030
y.create.l HWIO_APPS_SMMU_CB15_TCR_LPAE_2_APPS_ADDR A:0x61e1f030
y.create.l HWIO_APPS_SMMU_CB0_CONTEXTIDR_2_APPS_ADDR A:0x61e10034
y.create.l HWIO_APPS_SMMU_CB1_CONTEXTIDR_2_APPS_ADDR A:0x61e11034
y.create.l HWIO_APPS_SMMU_CB2_CONTEXTIDR_2_APPS_ADDR A:0x61e12034
y.create.l HWIO_APPS_SMMU_CB3_CONTEXTIDR_2_APPS_ADDR A:0x61e13034
y.create.l HWIO_APPS_SMMU_CB4_CONTEXTIDR_2_APPS_ADDR A:0x61e14034
y.create.l HWIO_APPS_SMMU_CB5_CONTEXTIDR_2_APPS_ADDR A:0x61e15034
y.create.l HWIO_APPS_SMMU_CB6_CONTEXTIDR_2_APPS_ADDR A:0x61e16034
y.create.l HWIO_APPS_SMMU_CB7_CONTEXTIDR_2_APPS_ADDR A:0x61e17034
y.create.l HWIO_APPS_SMMU_CB8_CONTEXTIDR_2_APPS_ADDR A:0x61e18034
y.create.l HWIO_APPS_SMMU_CB9_CONTEXTIDR_2_APPS_ADDR A:0x61e19034
y.create.l HWIO_APPS_SMMU_CB10_CONTEXTIDR_2_APPS_ADDR A:0x61e1a034
y.create.l HWIO_APPS_SMMU_CB11_CONTEXTIDR_2_APPS_ADDR A:0x61e1b034
y.create.l HWIO_APPS_SMMU_CB12_CONTEXTIDR_2_APPS_ADDR A:0x61e1c034
y.create.l HWIO_APPS_SMMU_CB13_CONTEXTIDR_2_APPS_ADDR A:0x61e1d034
y.create.l HWIO_APPS_SMMU_CB14_CONTEXTIDR_2_APPS_ADDR A:0x61e1e034
y.create.l HWIO_APPS_SMMU_CB15_CONTEXTIDR_2_APPS_ADDR A:0x61e1f034
y.create.l HWIO_APPS_SMMU_CB0_PRRR_MAIR0_2_APPS_ADDR A:0x61e10038
y.create.l HWIO_APPS_SMMU_CB1_PRRR_MAIR0_2_APPS_ADDR A:0x61e11038
y.create.l HWIO_APPS_SMMU_CB2_PRRR_MAIR0_2_APPS_ADDR A:0x61e12038
y.create.l HWIO_APPS_SMMU_CB3_PRRR_MAIR0_2_APPS_ADDR A:0x61e13038
y.create.l HWIO_APPS_SMMU_CB4_PRRR_MAIR0_2_APPS_ADDR A:0x61e14038
y.create.l HWIO_APPS_SMMU_CB5_PRRR_MAIR0_2_APPS_ADDR A:0x61e15038
y.create.l HWIO_APPS_SMMU_CB6_PRRR_MAIR0_2_APPS_ADDR A:0x61e16038
y.create.l HWIO_APPS_SMMU_CB7_PRRR_MAIR0_2_APPS_ADDR A:0x61e17038
y.create.l HWIO_APPS_SMMU_CB8_PRRR_MAIR0_2_APPS_ADDR A:0x61e18038
y.create.l HWIO_APPS_SMMU_CB9_PRRR_MAIR0_2_APPS_ADDR A:0x61e19038
y.create.l HWIO_APPS_SMMU_CB10_PRRR_MAIR0_2_APPS_ADDR A:0x61e1a038
y.create.l HWIO_APPS_SMMU_CB11_PRRR_MAIR0_2_APPS_ADDR A:0x61e1b038
y.create.l HWIO_APPS_SMMU_CB12_PRRR_MAIR0_2_APPS_ADDR A:0x61e1c038
y.create.l HWIO_APPS_SMMU_CB13_PRRR_MAIR0_2_APPS_ADDR A:0x61e1d038
y.create.l HWIO_APPS_SMMU_CB14_PRRR_MAIR0_2_APPS_ADDR A:0x61e1e038
y.create.l HWIO_APPS_SMMU_CB15_PRRR_MAIR0_2_APPS_ADDR A:0x61e1f038
y.create.l HWIO_APPS_SMMU_CB0_NMRR_MAIR1_2_APPS_ADDR A:0x61e1003c
y.create.l HWIO_APPS_SMMU_CB1_NMRR_MAIR1_2_APPS_ADDR A:0x61e1103c
y.create.l HWIO_APPS_SMMU_CB2_NMRR_MAIR1_2_APPS_ADDR A:0x61e1203c
y.create.l HWIO_APPS_SMMU_CB3_NMRR_MAIR1_2_APPS_ADDR A:0x61e1303c
y.create.l HWIO_APPS_SMMU_CB4_NMRR_MAIR1_2_APPS_ADDR A:0x61e1403c
y.create.l HWIO_APPS_SMMU_CB5_NMRR_MAIR1_2_APPS_ADDR A:0x61e1503c
y.create.l HWIO_APPS_SMMU_CB6_NMRR_MAIR1_2_APPS_ADDR A:0x61e1603c
y.create.l HWIO_APPS_SMMU_CB7_NMRR_MAIR1_2_APPS_ADDR A:0x61e1703c
y.create.l HWIO_APPS_SMMU_CB8_NMRR_MAIR1_2_APPS_ADDR A:0x61e1803c
y.create.l HWIO_APPS_SMMU_CB9_NMRR_MAIR1_2_APPS_ADDR A:0x61e1903c
y.create.l HWIO_APPS_SMMU_CB10_NMRR_MAIR1_2_APPS_ADDR A:0x61e1a03c
y.create.l HWIO_APPS_SMMU_CB11_NMRR_MAIR1_2_APPS_ADDR A:0x61e1b03c
y.create.l HWIO_APPS_SMMU_CB12_NMRR_MAIR1_2_APPS_ADDR A:0x61e1c03c
y.create.l HWIO_APPS_SMMU_CB13_NMRR_MAIR1_2_APPS_ADDR A:0x61e1d03c
y.create.l HWIO_APPS_SMMU_CB14_NMRR_MAIR1_2_APPS_ADDR A:0x61e1e03c
y.create.l HWIO_APPS_SMMU_CB15_NMRR_MAIR1_2_APPS_ADDR A:0x61e1f03c
y.create.l HWIO_APPS_SMMU_CB0_FSR_2_APPS_ADDR A:0x61e10058
y.create.l HWIO_APPS_SMMU_CB1_FSR_2_APPS_ADDR A:0x61e11058
y.create.l HWIO_APPS_SMMU_CB2_FSR_2_APPS_ADDR A:0x61e12058
y.create.l HWIO_APPS_SMMU_CB3_FSR_2_APPS_ADDR A:0x61e13058
y.create.l HWIO_APPS_SMMU_CB4_FSR_2_APPS_ADDR A:0x61e14058
y.create.l HWIO_APPS_SMMU_CB5_FSR_2_APPS_ADDR A:0x61e15058
y.create.l HWIO_APPS_SMMU_CB6_FSR_2_APPS_ADDR A:0x61e16058
y.create.l HWIO_APPS_SMMU_CB7_FSR_2_APPS_ADDR A:0x61e17058
y.create.l HWIO_APPS_SMMU_CB8_FSR_2_APPS_ADDR A:0x61e18058
y.create.l HWIO_APPS_SMMU_CB9_FSR_2_APPS_ADDR A:0x61e19058
y.create.l HWIO_APPS_SMMU_CB10_FSR_2_APPS_ADDR A:0x61e1a058
y.create.l HWIO_APPS_SMMU_CB11_FSR_2_APPS_ADDR A:0x61e1b058
y.create.l HWIO_APPS_SMMU_CB12_FSR_2_APPS_ADDR A:0x61e1c058
y.create.l HWIO_APPS_SMMU_CB13_FSR_2_APPS_ADDR A:0x61e1d058
y.create.l HWIO_APPS_SMMU_CB14_FSR_2_APPS_ADDR A:0x61e1e058
y.create.l HWIO_APPS_SMMU_CB15_FSR_2_APPS_ADDR A:0x61e1f058
y.create.l HWIO_APPS_SMMU_CB0_FSRRESTORE_2_APPS_ADDR A:0x61e1005c
y.create.l HWIO_APPS_SMMU_CB1_FSRRESTORE_2_APPS_ADDR A:0x61e1105c
y.create.l HWIO_APPS_SMMU_CB2_FSRRESTORE_2_APPS_ADDR A:0x61e1205c
y.create.l HWIO_APPS_SMMU_CB3_FSRRESTORE_2_APPS_ADDR A:0x61e1305c
y.create.l HWIO_APPS_SMMU_CB4_FSRRESTORE_2_APPS_ADDR A:0x61e1405c
y.create.l HWIO_APPS_SMMU_CB5_FSRRESTORE_2_APPS_ADDR A:0x61e1505c
y.create.l HWIO_APPS_SMMU_CB6_FSRRESTORE_2_APPS_ADDR A:0x61e1605c
y.create.l HWIO_APPS_SMMU_CB7_FSRRESTORE_2_APPS_ADDR A:0x61e1705c
y.create.l HWIO_APPS_SMMU_CB8_FSRRESTORE_2_APPS_ADDR A:0x61e1805c
y.create.l HWIO_APPS_SMMU_CB9_FSRRESTORE_2_APPS_ADDR A:0x61e1905c
y.create.l HWIO_APPS_SMMU_CB10_FSRRESTORE_2_APPS_ADDR A:0x61e1a05c
y.create.l HWIO_APPS_SMMU_CB11_FSRRESTORE_2_APPS_ADDR A:0x61e1b05c
y.create.l HWIO_APPS_SMMU_CB12_FSRRESTORE_2_APPS_ADDR A:0x61e1c05c
y.create.l HWIO_APPS_SMMU_CB13_FSRRESTORE_2_APPS_ADDR A:0x61e1d05c
y.create.l HWIO_APPS_SMMU_CB14_FSRRESTORE_2_APPS_ADDR A:0x61e1e05c
y.create.l HWIO_APPS_SMMU_CB15_FSRRESTORE_2_APPS_ADDR A:0x61e1f05c
y.create.l HWIO_APPS_SMMU_CB0_FAR_LOW_2_APPS_ADDR A:0x61e10060
y.create.l HWIO_APPS_SMMU_CB1_FAR_LOW_2_APPS_ADDR A:0x61e11060
y.create.l HWIO_APPS_SMMU_CB2_FAR_LOW_2_APPS_ADDR A:0x61e12060
y.create.l HWIO_APPS_SMMU_CB3_FAR_LOW_2_APPS_ADDR A:0x61e13060
y.create.l HWIO_APPS_SMMU_CB4_FAR_LOW_2_APPS_ADDR A:0x61e14060
y.create.l HWIO_APPS_SMMU_CB5_FAR_LOW_2_APPS_ADDR A:0x61e15060
y.create.l HWIO_APPS_SMMU_CB6_FAR_LOW_2_APPS_ADDR A:0x61e16060
y.create.l HWIO_APPS_SMMU_CB7_FAR_LOW_2_APPS_ADDR A:0x61e17060
y.create.l HWIO_APPS_SMMU_CB8_FAR_LOW_2_APPS_ADDR A:0x61e18060
y.create.l HWIO_APPS_SMMU_CB9_FAR_LOW_2_APPS_ADDR A:0x61e19060
y.create.l HWIO_APPS_SMMU_CB10_FAR_LOW_2_APPS_ADDR A:0x61e1a060
y.create.l HWIO_APPS_SMMU_CB11_FAR_LOW_2_APPS_ADDR A:0x61e1b060
y.create.l HWIO_APPS_SMMU_CB12_FAR_LOW_2_APPS_ADDR A:0x61e1c060
y.create.l HWIO_APPS_SMMU_CB13_FAR_LOW_2_APPS_ADDR A:0x61e1d060
y.create.l HWIO_APPS_SMMU_CB14_FAR_LOW_2_APPS_ADDR A:0x61e1e060
y.create.l HWIO_APPS_SMMU_CB15_FAR_LOW_2_APPS_ADDR A:0x61e1f060
y.create.l HWIO_APPS_SMMU_CB0_FAR_HIGH_2_APPS_ADDR A:0x61e10064
y.create.l HWIO_APPS_SMMU_CB1_FAR_HIGH_2_APPS_ADDR A:0x61e11064
y.create.l HWIO_APPS_SMMU_CB2_FAR_HIGH_2_APPS_ADDR A:0x61e12064
y.create.l HWIO_APPS_SMMU_CB3_FAR_HIGH_2_APPS_ADDR A:0x61e13064
y.create.l HWIO_APPS_SMMU_CB4_FAR_HIGH_2_APPS_ADDR A:0x61e14064
y.create.l HWIO_APPS_SMMU_CB5_FAR_HIGH_2_APPS_ADDR A:0x61e15064
y.create.l HWIO_APPS_SMMU_CB6_FAR_HIGH_2_APPS_ADDR A:0x61e16064
y.create.l HWIO_APPS_SMMU_CB7_FAR_HIGH_2_APPS_ADDR A:0x61e17064
y.create.l HWIO_APPS_SMMU_CB8_FAR_HIGH_2_APPS_ADDR A:0x61e18064
y.create.l HWIO_APPS_SMMU_CB9_FAR_HIGH_2_APPS_ADDR A:0x61e19064
y.create.l HWIO_APPS_SMMU_CB10_FAR_HIGH_2_APPS_ADDR A:0x61e1a064
y.create.l HWIO_APPS_SMMU_CB11_FAR_HIGH_2_APPS_ADDR A:0x61e1b064
y.create.l HWIO_APPS_SMMU_CB12_FAR_HIGH_2_APPS_ADDR A:0x61e1c064
y.create.l HWIO_APPS_SMMU_CB13_FAR_HIGH_2_APPS_ADDR A:0x61e1d064
y.create.l HWIO_APPS_SMMU_CB14_FAR_HIGH_2_APPS_ADDR A:0x61e1e064
y.create.l HWIO_APPS_SMMU_CB15_FAR_HIGH_2_APPS_ADDR A:0x61e1f064
y.create.l HWIO_APPS_SMMU_CB0_FSYNR0_2_APPS_ADDR A:0x61e10068
y.create.l HWIO_APPS_SMMU_CB1_FSYNR0_2_APPS_ADDR A:0x61e11068
y.create.l HWIO_APPS_SMMU_CB2_FSYNR0_2_APPS_ADDR A:0x61e12068
y.create.l HWIO_APPS_SMMU_CB3_FSYNR0_2_APPS_ADDR A:0x61e13068
y.create.l HWIO_APPS_SMMU_CB4_FSYNR0_2_APPS_ADDR A:0x61e14068
y.create.l HWIO_APPS_SMMU_CB5_FSYNR0_2_APPS_ADDR A:0x61e15068
y.create.l HWIO_APPS_SMMU_CB6_FSYNR0_2_APPS_ADDR A:0x61e16068
y.create.l HWIO_APPS_SMMU_CB7_FSYNR0_2_APPS_ADDR A:0x61e17068
y.create.l HWIO_APPS_SMMU_CB8_FSYNR0_2_APPS_ADDR A:0x61e18068
y.create.l HWIO_APPS_SMMU_CB9_FSYNR0_2_APPS_ADDR A:0x61e19068
y.create.l HWIO_APPS_SMMU_CB10_FSYNR0_2_APPS_ADDR A:0x61e1a068
y.create.l HWIO_APPS_SMMU_CB11_FSYNR0_2_APPS_ADDR A:0x61e1b068
y.create.l HWIO_APPS_SMMU_CB12_FSYNR0_2_APPS_ADDR A:0x61e1c068
y.create.l HWIO_APPS_SMMU_CB13_FSYNR0_2_APPS_ADDR A:0x61e1d068
y.create.l HWIO_APPS_SMMU_CB14_FSYNR0_2_APPS_ADDR A:0x61e1e068
y.create.l HWIO_APPS_SMMU_CB15_FSYNR0_2_APPS_ADDR A:0x61e1f068
y.create.l HWIO_APPS_SMMU_CB0_IPAFAR_LOW_2_APPS_ADDR A:0x61e10070
y.create.l HWIO_APPS_SMMU_CB1_IPAFAR_LOW_2_APPS_ADDR A:0x61e11070
y.create.l HWIO_APPS_SMMU_CB2_IPAFAR_LOW_2_APPS_ADDR A:0x61e12070
y.create.l HWIO_APPS_SMMU_CB3_IPAFAR_LOW_2_APPS_ADDR A:0x61e13070
y.create.l HWIO_APPS_SMMU_CB4_IPAFAR_LOW_2_APPS_ADDR A:0x61e14070
y.create.l HWIO_APPS_SMMU_CB5_IPAFAR_LOW_2_APPS_ADDR A:0x61e15070
y.create.l HWIO_APPS_SMMU_CB6_IPAFAR_LOW_2_APPS_ADDR A:0x61e16070
y.create.l HWIO_APPS_SMMU_CB7_IPAFAR_LOW_2_APPS_ADDR A:0x61e17070
y.create.l HWIO_APPS_SMMU_CB8_IPAFAR_LOW_2_APPS_ADDR A:0x61e18070
y.create.l HWIO_APPS_SMMU_CB9_IPAFAR_LOW_2_APPS_ADDR A:0x61e19070
y.create.l HWIO_APPS_SMMU_CB10_IPAFAR_LOW_2_APPS_ADDR A:0x61e1a070
y.create.l HWIO_APPS_SMMU_CB11_IPAFAR_LOW_2_APPS_ADDR A:0x61e1b070
y.create.l HWIO_APPS_SMMU_CB12_IPAFAR_LOW_2_APPS_ADDR A:0x61e1c070
y.create.l HWIO_APPS_SMMU_CB13_IPAFAR_LOW_2_APPS_ADDR A:0x61e1d070
y.create.l HWIO_APPS_SMMU_CB14_IPAFAR_LOW_2_APPS_ADDR A:0x61e1e070
y.create.l HWIO_APPS_SMMU_CB15_IPAFAR_LOW_2_APPS_ADDR A:0x61e1f070
y.create.l HWIO_APPS_SMMU_CB0_IPAFAR_HIGH_2_APPS_ADDR A:0x61e10074
y.create.l HWIO_APPS_SMMU_CB1_IPAFAR_HIGH_2_APPS_ADDR A:0x61e11074
y.create.l HWIO_APPS_SMMU_CB2_IPAFAR_HIGH_2_APPS_ADDR A:0x61e12074
y.create.l HWIO_APPS_SMMU_CB3_IPAFAR_HIGH_2_APPS_ADDR A:0x61e13074
y.create.l HWIO_APPS_SMMU_CB4_IPAFAR_HIGH_2_APPS_ADDR A:0x61e14074
y.create.l HWIO_APPS_SMMU_CB5_IPAFAR_HIGH_2_APPS_ADDR A:0x61e15074
y.create.l HWIO_APPS_SMMU_CB6_IPAFAR_HIGH_2_APPS_ADDR A:0x61e16074
y.create.l HWIO_APPS_SMMU_CB7_IPAFAR_HIGH_2_APPS_ADDR A:0x61e17074
y.create.l HWIO_APPS_SMMU_CB8_IPAFAR_HIGH_2_APPS_ADDR A:0x61e18074
y.create.l HWIO_APPS_SMMU_CB9_IPAFAR_HIGH_2_APPS_ADDR A:0x61e19074
y.create.l HWIO_APPS_SMMU_CB10_IPAFAR_HIGH_2_APPS_ADDR A:0x61e1a074
y.create.l HWIO_APPS_SMMU_CB11_IPAFAR_HIGH_2_APPS_ADDR A:0x61e1b074
y.create.l HWIO_APPS_SMMU_CB12_IPAFAR_HIGH_2_APPS_ADDR A:0x61e1c074
y.create.l HWIO_APPS_SMMU_CB13_IPAFAR_HIGH_2_APPS_ADDR A:0x61e1d074
y.create.l HWIO_APPS_SMMU_CB14_IPAFAR_HIGH_2_APPS_ADDR A:0x61e1e074
y.create.l HWIO_APPS_SMMU_CB15_IPAFAR_HIGH_2_APPS_ADDR A:0x61e1f074
y.create.l HWIO_APPS_SMMU_CB0_TLBIVA_LOW_2_APPS_ADDR A:0x61e10600
y.create.l HWIO_APPS_SMMU_CB1_TLBIVA_LOW_2_APPS_ADDR A:0x61e11600
y.create.l HWIO_APPS_SMMU_CB2_TLBIVA_LOW_2_APPS_ADDR A:0x61e12600
y.create.l HWIO_APPS_SMMU_CB3_TLBIVA_LOW_2_APPS_ADDR A:0x61e13600
y.create.l HWIO_APPS_SMMU_CB4_TLBIVA_LOW_2_APPS_ADDR A:0x61e14600
y.create.l HWIO_APPS_SMMU_CB5_TLBIVA_LOW_2_APPS_ADDR A:0x61e15600
y.create.l HWIO_APPS_SMMU_CB6_TLBIVA_LOW_2_APPS_ADDR A:0x61e16600
y.create.l HWIO_APPS_SMMU_CB7_TLBIVA_LOW_2_APPS_ADDR A:0x61e17600
y.create.l HWIO_APPS_SMMU_CB8_TLBIVA_LOW_2_APPS_ADDR A:0x61e18600
y.create.l HWIO_APPS_SMMU_CB9_TLBIVA_LOW_2_APPS_ADDR A:0x61e19600
y.create.l HWIO_APPS_SMMU_CB10_TLBIVA_LOW_2_APPS_ADDR A:0x61e1a600
y.create.l HWIO_APPS_SMMU_CB11_TLBIVA_LOW_2_APPS_ADDR A:0x61e1b600
y.create.l HWIO_APPS_SMMU_CB12_TLBIVA_LOW_2_APPS_ADDR A:0x61e1c600
y.create.l HWIO_APPS_SMMU_CB13_TLBIVA_LOW_2_APPS_ADDR A:0x61e1d600
y.create.l HWIO_APPS_SMMU_CB14_TLBIVA_LOW_2_APPS_ADDR A:0x61e1e600
y.create.l HWIO_APPS_SMMU_CB15_TLBIVA_LOW_2_APPS_ADDR A:0x61e1f600
y.create.l HWIO_APPS_SMMU_CB0_TLBIVA_HIGH_2_APPS_ADDR A:0x61e10604
y.create.l HWIO_APPS_SMMU_CB1_TLBIVA_HIGH_2_APPS_ADDR A:0x61e11604
y.create.l HWIO_APPS_SMMU_CB2_TLBIVA_HIGH_2_APPS_ADDR A:0x61e12604
y.create.l HWIO_APPS_SMMU_CB3_TLBIVA_HIGH_2_APPS_ADDR A:0x61e13604
y.create.l HWIO_APPS_SMMU_CB4_TLBIVA_HIGH_2_APPS_ADDR A:0x61e14604
y.create.l HWIO_APPS_SMMU_CB5_TLBIVA_HIGH_2_APPS_ADDR A:0x61e15604
y.create.l HWIO_APPS_SMMU_CB6_TLBIVA_HIGH_2_APPS_ADDR A:0x61e16604
y.create.l HWIO_APPS_SMMU_CB7_TLBIVA_HIGH_2_APPS_ADDR A:0x61e17604
y.create.l HWIO_APPS_SMMU_CB8_TLBIVA_HIGH_2_APPS_ADDR A:0x61e18604
y.create.l HWIO_APPS_SMMU_CB9_TLBIVA_HIGH_2_APPS_ADDR A:0x61e19604
y.create.l HWIO_APPS_SMMU_CB10_TLBIVA_HIGH_2_APPS_ADDR A:0x61e1a604
y.create.l HWIO_APPS_SMMU_CB11_TLBIVA_HIGH_2_APPS_ADDR A:0x61e1b604
y.create.l HWIO_APPS_SMMU_CB12_TLBIVA_HIGH_2_APPS_ADDR A:0x61e1c604
y.create.l HWIO_APPS_SMMU_CB13_TLBIVA_HIGH_2_APPS_ADDR A:0x61e1d604
y.create.l HWIO_APPS_SMMU_CB14_TLBIVA_HIGH_2_APPS_ADDR A:0x61e1e604
y.create.l HWIO_APPS_SMMU_CB15_TLBIVA_HIGH_2_APPS_ADDR A:0x61e1f604
y.create.l HWIO_APPS_SMMU_CB0_TLBIVAA_LOW_2_APPS_ADDR A:0x61e10608
y.create.l HWIO_APPS_SMMU_CB1_TLBIVAA_LOW_2_APPS_ADDR A:0x61e11608
y.create.l HWIO_APPS_SMMU_CB2_TLBIVAA_LOW_2_APPS_ADDR A:0x61e12608
y.create.l HWIO_APPS_SMMU_CB3_TLBIVAA_LOW_2_APPS_ADDR A:0x61e13608
y.create.l HWIO_APPS_SMMU_CB4_TLBIVAA_LOW_2_APPS_ADDR A:0x61e14608
y.create.l HWIO_APPS_SMMU_CB5_TLBIVAA_LOW_2_APPS_ADDR A:0x61e15608
y.create.l HWIO_APPS_SMMU_CB6_TLBIVAA_LOW_2_APPS_ADDR A:0x61e16608
y.create.l HWIO_APPS_SMMU_CB7_TLBIVAA_LOW_2_APPS_ADDR A:0x61e17608
y.create.l HWIO_APPS_SMMU_CB8_TLBIVAA_LOW_2_APPS_ADDR A:0x61e18608
y.create.l HWIO_APPS_SMMU_CB9_TLBIVAA_LOW_2_APPS_ADDR A:0x61e19608
y.create.l HWIO_APPS_SMMU_CB10_TLBIVAA_LOW_2_APPS_ADDR A:0x61e1a608
y.create.l HWIO_APPS_SMMU_CB11_TLBIVAA_LOW_2_APPS_ADDR A:0x61e1b608
y.create.l HWIO_APPS_SMMU_CB12_TLBIVAA_LOW_2_APPS_ADDR A:0x61e1c608
y.create.l HWIO_APPS_SMMU_CB13_TLBIVAA_LOW_2_APPS_ADDR A:0x61e1d608
y.create.l HWIO_APPS_SMMU_CB14_TLBIVAA_LOW_2_APPS_ADDR A:0x61e1e608
y.create.l HWIO_APPS_SMMU_CB15_TLBIVAA_LOW_2_APPS_ADDR A:0x61e1f608
y.create.l HWIO_APPS_SMMU_CB0_TLBIVAA_HIGH_2_APPS_ADDR A:0x61e1060c
y.create.l HWIO_APPS_SMMU_CB1_TLBIVAA_HIGH_2_APPS_ADDR A:0x61e1160c
y.create.l HWIO_APPS_SMMU_CB2_TLBIVAA_HIGH_2_APPS_ADDR A:0x61e1260c
y.create.l HWIO_APPS_SMMU_CB3_TLBIVAA_HIGH_2_APPS_ADDR A:0x61e1360c
y.create.l HWIO_APPS_SMMU_CB4_TLBIVAA_HIGH_2_APPS_ADDR A:0x61e1460c
y.create.l HWIO_APPS_SMMU_CB5_TLBIVAA_HIGH_2_APPS_ADDR A:0x61e1560c
y.create.l HWIO_APPS_SMMU_CB6_TLBIVAA_HIGH_2_APPS_ADDR A:0x61e1660c
y.create.l HWIO_APPS_SMMU_CB7_TLBIVAA_HIGH_2_APPS_ADDR A:0x61e1760c
y.create.l HWIO_APPS_SMMU_CB8_TLBIVAA_HIGH_2_APPS_ADDR A:0x61e1860c
y.create.l HWIO_APPS_SMMU_CB9_TLBIVAA_HIGH_2_APPS_ADDR A:0x61e1960c
y.create.l HWIO_APPS_SMMU_CB10_TLBIVAA_HIGH_2_APPS_ADDR A:0x61e1a60c
y.create.l HWIO_APPS_SMMU_CB11_TLBIVAA_HIGH_2_APPS_ADDR A:0x61e1b60c
y.create.l HWIO_APPS_SMMU_CB12_TLBIVAA_HIGH_2_APPS_ADDR A:0x61e1c60c
y.create.l HWIO_APPS_SMMU_CB13_TLBIVAA_HIGH_2_APPS_ADDR A:0x61e1d60c
y.create.l HWIO_APPS_SMMU_CB14_TLBIVAA_HIGH_2_APPS_ADDR A:0x61e1e60c
y.create.l HWIO_APPS_SMMU_CB15_TLBIVAA_HIGH_2_APPS_ADDR A:0x61e1f60c
y.create.l HWIO_APPS_SMMU_CB0_TLBIASID_2_APPS_ADDR A:0x61e10610
y.create.l HWIO_APPS_SMMU_CB1_TLBIASID_2_APPS_ADDR A:0x61e11610
y.create.l HWIO_APPS_SMMU_CB2_TLBIASID_2_APPS_ADDR A:0x61e12610
y.create.l HWIO_APPS_SMMU_CB3_TLBIASID_2_APPS_ADDR A:0x61e13610
y.create.l HWIO_APPS_SMMU_CB4_TLBIASID_2_APPS_ADDR A:0x61e14610
y.create.l HWIO_APPS_SMMU_CB5_TLBIASID_2_APPS_ADDR A:0x61e15610
y.create.l HWIO_APPS_SMMU_CB6_TLBIASID_2_APPS_ADDR A:0x61e16610
y.create.l HWIO_APPS_SMMU_CB7_TLBIASID_2_APPS_ADDR A:0x61e17610
y.create.l HWIO_APPS_SMMU_CB8_TLBIASID_2_APPS_ADDR A:0x61e18610
y.create.l HWIO_APPS_SMMU_CB9_TLBIASID_2_APPS_ADDR A:0x61e19610
y.create.l HWIO_APPS_SMMU_CB10_TLBIASID_2_APPS_ADDR A:0x61e1a610
y.create.l HWIO_APPS_SMMU_CB11_TLBIASID_2_APPS_ADDR A:0x61e1b610
y.create.l HWIO_APPS_SMMU_CB12_TLBIASID_2_APPS_ADDR A:0x61e1c610
y.create.l HWIO_APPS_SMMU_CB13_TLBIASID_2_APPS_ADDR A:0x61e1d610
y.create.l HWIO_APPS_SMMU_CB14_TLBIASID_2_APPS_ADDR A:0x61e1e610
y.create.l HWIO_APPS_SMMU_CB15_TLBIASID_2_APPS_ADDR A:0x61e1f610
y.create.l HWIO_APPS_SMMU_CB0_TLBIALL_2_APPS_ADDR A:0x61e10618
y.create.l HWIO_APPS_SMMU_CB1_TLBIALL_2_APPS_ADDR A:0x61e11618
y.create.l HWIO_APPS_SMMU_CB2_TLBIALL_2_APPS_ADDR A:0x61e12618
y.create.l HWIO_APPS_SMMU_CB3_TLBIALL_2_APPS_ADDR A:0x61e13618
y.create.l HWIO_APPS_SMMU_CB4_TLBIALL_2_APPS_ADDR A:0x61e14618
y.create.l HWIO_APPS_SMMU_CB5_TLBIALL_2_APPS_ADDR A:0x61e15618
y.create.l HWIO_APPS_SMMU_CB6_TLBIALL_2_APPS_ADDR A:0x61e16618
y.create.l HWIO_APPS_SMMU_CB7_TLBIALL_2_APPS_ADDR A:0x61e17618
y.create.l HWIO_APPS_SMMU_CB8_TLBIALL_2_APPS_ADDR A:0x61e18618
y.create.l HWIO_APPS_SMMU_CB9_TLBIALL_2_APPS_ADDR A:0x61e19618
y.create.l HWIO_APPS_SMMU_CB10_TLBIALL_2_APPS_ADDR A:0x61e1a618
y.create.l HWIO_APPS_SMMU_CB11_TLBIALL_2_APPS_ADDR A:0x61e1b618
y.create.l HWIO_APPS_SMMU_CB12_TLBIALL_2_APPS_ADDR A:0x61e1c618
y.create.l HWIO_APPS_SMMU_CB13_TLBIALL_2_APPS_ADDR A:0x61e1d618
y.create.l HWIO_APPS_SMMU_CB14_TLBIALL_2_APPS_ADDR A:0x61e1e618
y.create.l HWIO_APPS_SMMU_CB15_TLBIALL_2_APPS_ADDR A:0x61e1f618
y.create.l HWIO_APPS_SMMU_CB0_TLBIVAL_LOW_2_APPS_ADDR A:0x61e10620
y.create.l HWIO_APPS_SMMU_CB1_TLBIVAL_LOW_2_APPS_ADDR A:0x61e11620
y.create.l HWIO_APPS_SMMU_CB2_TLBIVAL_LOW_2_APPS_ADDR A:0x61e12620
y.create.l HWIO_APPS_SMMU_CB3_TLBIVAL_LOW_2_APPS_ADDR A:0x61e13620
y.create.l HWIO_APPS_SMMU_CB4_TLBIVAL_LOW_2_APPS_ADDR A:0x61e14620
y.create.l HWIO_APPS_SMMU_CB5_TLBIVAL_LOW_2_APPS_ADDR A:0x61e15620
y.create.l HWIO_APPS_SMMU_CB6_TLBIVAL_LOW_2_APPS_ADDR A:0x61e16620
y.create.l HWIO_APPS_SMMU_CB7_TLBIVAL_LOW_2_APPS_ADDR A:0x61e17620
y.create.l HWIO_APPS_SMMU_CB8_TLBIVAL_LOW_2_APPS_ADDR A:0x61e18620
y.create.l HWIO_APPS_SMMU_CB9_TLBIVAL_LOW_2_APPS_ADDR A:0x61e19620
y.create.l HWIO_APPS_SMMU_CB10_TLBIVAL_LOW_2_APPS_ADDR A:0x61e1a620
y.create.l HWIO_APPS_SMMU_CB11_TLBIVAL_LOW_2_APPS_ADDR A:0x61e1b620
y.create.l HWIO_APPS_SMMU_CB12_TLBIVAL_LOW_2_APPS_ADDR A:0x61e1c620
y.create.l HWIO_APPS_SMMU_CB13_TLBIVAL_LOW_2_APPS_ADDR A:0x61e1d620
y.create.l HWIO_APPS_SMMU_CB14_TLBIVAL_LOW_2_APPS_ADDR A:0x61e1e620
y.create.l HWIO_APPS_SMMU_CB15_TLBIVAL_LOW_2_APPS_ADDR A:0x61e1f620
y.create.l HWIO_APPS_SMMU_CB0_TLBIVAL_HIGH_2_APPS_ADDR A:0x61e10624
y.create.l HWIO_APPS_SMMU_CB1_TLBIVAL_HIGH_2_APPS_ADDR A:0x61e11624
y.create.l HWIO_APPS_SMMU_CB2_TLBIVAL_HIGH_2_APPS_ADDR A:0x61e12624
y.create.l HWIO_APPS_SMMU_CB3_TLBIVAL_HIGH_2_APPS_ADDR A:0x61e13624
y.create.l HWIO_APPS_SMMU_CB4_TLBIVAL_HIGH_2_APPS_ADDR A:0x61e14624
y.create.l HWIO_APPS_SMMU_CB5_TLBIVAL_HIGH_2_APPS_ADDR A:0x61e15624
y.create.l HWIO_APPS_SMMU_CB6_TLBIVAL_HIGH_2_APPS_ADDR A:0x61e16624
y.create.l HWIO_APPS_SMMU_CB7_TLBIVAL_HIGH_2_APPS_ADDR A:0x61e17624
y.create.l HWIO_APPS_SMMU_CB8_TLBIVAL_HIGH_2_APPS_ADDR A:0x61e18624
y.create.l HWIO_APPS_SMMU_CB9_TLBIVAL_HIGH_2_APPS_ADDR A:0x61e19624
y.create.l HWIO_APPS_SMMU_CB10_TLBIVAL_HIGH_2_APPS_ADDR A:0x61e1a624
y.create.l HWIO_APPS_SMMU_CB11_TLBIVAL_HIGH_2_APPS_ADDR A:0x61e1b624
y.create.l HWIO_APPS_SMMU_CB12_TLBIVAL_HIGH_2_APPS_ADDR A:0x61e1c624
y.create.l HWIO_APPS_SMMU_CB13_TLBIVAL_HIGH_2_APPS_ADDR A:0x61e1d624
y.create.l HWIO_APPS_SMMU_CB14_TLBIVAL_HIGH_2_APPS_ADDR A:0x61e1e624
y.create.l HWIO_APPS_SMMU_CB15_TLBIVAL_HIGH_2_APPS_ADDR A:0x61e1f624
y.create.l HWIO_APPS_SMMU_CB0_TLBIVAAL_LOW_2_APPS_ADDR A:0x61e10628
y.create.l HWIO_APPS_SMMU_CB1_TLBIVAAL_LOW_2_APPS_ADDR A:0x61e11628
y.create.l HWIO_APPS_SMMU_CB2_TLBIVAAL_LOW_2_APPS_ADDR A:0x61e12628
y.create.l HWIO_APPS_SMMU_CB3_TLBIVAAL_LOW_2_APPS_ADDR A:0x61e13628
y.create.l HWIO_APPS_SMMU_CB4_TLBIVAAL_LOW_2_APPS_ADDR A:0x61e14628
y.create.l HWIO_APPS_SMMU_CB5_TLBIVAAL_LOW_2_APPS_ADDR A:0x61e15628
y.create.l HWIO_APPS_SMMU_CB6_TLBIVAAL_LOW_2_APPS_ADDR A:0x61e16628
y.create.l HWIO_APPS_SMMU_CB7_TLBIVAAL_LOW_2_APPS_ADDR A:0x61e17628
y.create.l HWIO_APPS_SMMU_CB8_TLBIVAAL_LOW_2_APPS_ADDR A:0x61e18628
y.create.l HWIO_APPS_SMMU_CB9_TLBIVAAL_LOW_2_APPS_ADDR A:0x61e19628
y.create.l HWIO_APPS_SMMU_CB10_TLBIVAAL_LOW_2_APPS_ADDR A:0x61e1a628
y.create.l HWIO_APPS_SMMU_CB11_TLBIVAAL_LOW_2_APPS_ADDR A:0x61e1b628
y.create.l HWIO_APPS_SMMU_CB12_TLBIVAAL_LOW_2_APPS_ADDR A:0x61e1c628
y.create.l HWIO_APPS_SMMU_CB13_TLBIVAAL_LOW_2_APPS_ADDR A:0x61e1d628
y.create.l HWIO_APPS_SMMU_CB14_TLBIVAAL_LOW_2_APPS_ADDR A:0x61e1e628
y.create.l HWIO_APPS_SMMU_CB15_TLBIVAAL_LOW_2_APPS_ADDR A:0x61e1f628
y.create.l HWIO_APPS_SMMU_CB0_TLBIVAAL_HIGH_2_APPS_ADDR A:0x61e1062c
y.create.l HWIO_APPS_SMMU_CB1_TLBIVAAL_HIGH_2_APPS_ADDR A:0x61e1162c
y.create.l HWIO_APPS_SMMU_CB2_TLBIVAAL_HIGH_2_APPS_ADDR A:0x61e1262c
y.create.l HWIO_APPS_SMMU_CB3_TLBIVAAL_HIGH_2_APPS_ADDR A:0x61e1362c
y.create.l HWIO_APPS_SMMU_CB4_TLBIVAAL_HIGH_2_APPS_ADDR A:0x61e1462c
y.create.l HWIO_APPS_SMMU_CB5_TLBIVAAL_HIGH_2_APPS_ADDR A:0x61e1562c
y.create.l HWIO_APPS_SMMU_CB6_TLBIVAAL_HIGH_2_APPS_ADDR A:0x61e1662c
y.create.l HWIO_APPS_SMMU_CB7_TLBIVAAL_HIGH_2_APPS_ADDR A:0x61e1762c
y.create.l HWIO_APPS_SMMU_CB8_TLBIVAAL_HIGH_2_APPS_ADDR A:0x61e1862c
y.create.l HWIO_APPS_SMMU_CB9_TLBIVAAL_HIGH_2_APPS_ADDR A:0x61e1962c
y.create.l HWIO_APPS_SMMU_CB10_TLBIVAAL_HIGH_2_APPS_ADDR A:0x61e1a62c
y.create.l HWIO_APPS_SMMU_CB11_TLBIVAAL_HIGH_2_APPS_ADDR A:0x61e1b62c
y.create.l HWIO_APPS_SMMU_CB12_TLBIVAAL_HIGH_2_APPS_ADDR A:0x61e1c62c
y.create.l HWIO_APPS_SMMU_CB13_TLBIVAAL_HIGH_2_APPS_ADDR A:0x61e1d62c
y.create.l HWIO_APPS_SMMU_CB14_TLBIVAAL_HIGH_2_APPS_ADDR A:0x61e1e62c
y.create.l HWIO_APPS_SMMU_CB15_TLBIVAAL_HIGH_2_APPS_ADDR A:0x61e1f62c
y.create.l HWIO_APPS_SMMU_CB0_TLBIIPAS2_LOW_2_APPS_ADDR A:0x61e10630
y.create.l HWIO_APPS_SMMU_CB1_TLBIIPAS2_LOW_2_APPS_ADDR A:0x61e11630
y.create.l HWIO_APPS_SMMU_CB2_TLBIIPAS2_LOW_2_APPS_ADDR A:0x61e12630
y.create.l HWIO_APPS_SMMU_CB3_TLBIIPAS2_LOW_2_APPS_ADDR A:0x61e13630
y.create.l HWIO_APPS_SMMU_CB4_TLBIIPAS2_LOW_2_APPS_ADDR A:0x61e14630
y.create.l HWIO_APPS_SMMU_CB5_TLBIIPAS2_LOW_2_APPS_ADDR A:0x61e15630
y.create.l HWIO_APPS_SMMU_CB6_TLBIIPAS2_LOW_2_APPS_ADDR A:0x61e16630
y.create.l HWIO_APPS_SMMU_CB7_TLBIIPAS2_LOW_2_APPS_ADDR A:0x61e17630
y.create.l HWIO_APPS_SMMU_CB8_TLBIIPAS2_LOW_2_APPS_ADDR A:0x61e18630
y.create.l HWIO_APPS_SMMU_CB9_TLBIIPAS2_LOW_2_APPS_ADDR A:0x61e19630
y.create.l HWIO_APPS_SMMU_CB10_TLBIIPAS2_LOW_2_APPS_ADDR A:0x61e1a630
y.create.l HWIO_APPS_SMMU_CB11_TLBIIPAS2_LOW_2_APPS_ADDR A:0x61e1b630
y.create.l HWIO_APPS_SMMU_CB12_TLBIIPAS2_LOW_2_APPS_ADDR A:0x61e1c630
y.create.l HWIO_APPS_SMMU_CB13_TLBIIPAS2_LOW_2_APPS_ADDR A:0x61e1d630
y.create.l HWIO_APPS_SMMU_CB14_TLBIIPAS2_LOW_2_APPS_ADDR A:0x61e1e630
y.create.l HWIO_APPS_SMMU_CB15_TLBIIPAS2_LOW_2_APPS_ADDR A:0x61e1f630
y.create.l HWIO_APPS_SMMU_CB0_TLBIIPAS2_HIGH_2_APPS_ADDR A:0x61e10634
y.create.l HWIO_APPS_SMMU_CB1_TLBIIPAS2_HIGH_2_APPS_ADDR A:0x61e11634
y.create.l HWIO_APPS_SMMU_CB2_TLBIIPAS2_HIGH_2_APPS_ADDR A:0x61e12634
y.create.l HWIO_APPS_SMMU_CB3_TLBIIPAS2_HIGH_2_APPS_ADDR A:0x61e13634
y.create.l HWIO_APPS_SMMU_CB4_TLBIIPAS2_HIGH_2_APPS_ADDR A:0x61e14634
y.create.l HWIO_APPS_SMMU_CB5_TLBIIPAS2_HIGH_2_APPS_ADDR A:0x61e15634
y.create.l HWIO_APPS_SMMU_CB6_TLBIIPAS2_HIGH_2_APPS_ADDR A:0x61e16634
y.create.l HWIO_APPS_SMMU_CB7_TLBIIPAS2_HIGH_2_APPS_ADDR A:0x61e17634
y.create.l HWIO_APPS_SMMU_CB8_TLBIIPAS2_HIGH_2_APPS_ADDR A:0x61e18634
y.create.l HWIO_APPS_SMMU_CB9_TLBIIPAS2_HIGH_2_APPS_ADDR A:0x61e19634
y.create.l HWIO_APPS_SMMU_CB10_TLBIIPAS2_HIGH_2_APPS_ADDR A:0x61e1a634
y.create.l HWIO_APPS_SMMU_CB11_TLBIIPAS2_HIGH_2_APPS_ADDR A:0x61e1b634
y.create.l HWIO_APPS_SMMU_CB12_TLBIIPAS2_HIGH_2_APPS_ADDR A:0x61e1c634
y.create.l HWIO_APPS_SMMU_CB13_TLBIIPAS2_HIGH_2_APPS_ADDR A:0x61e1d634
y.create.l HWIO_APPS_SMMU_CB14_TLBIIPAS2_HIGH_2_APPS_ADDR A:0x61e1e634
y.create.l HWIO_APPS_SMMU_CB15_TLBIIPAS2_HIGH_2_APPS_ADDR A:0x61e1f634
y.create.l HWIO_APPS_SMMU_CB0_TLBIIPAS2L_LOW_2_APPS_ADDR A:0x61e10638
y.create.l HWIO_APPS_SMMU_CB1_TLBIIPAS2L_LOW_2_APPS_ADDR A:0x61e11638
y.create.l HWIO_APPS_SMMU_CB2_TLBIIPAS2L_LOW_2_APPS_ADDR A:0x61e12638
y.create.l HWIO_APPS_SMMU_CB3_TLBIIPAS2L_LOW_2_APPS_ADDR A:0x61e13638
y.create.l HWIO_APPS_SMMU_CB4_TLBIIPAS2L_LOW_2_APPS_ADDR A:0x61e14638
y.create.l HWIO_APPS_SMMU_CB5_TLBIIPAS2L_LOW_2_APPS_ADDR A:0x61e15638
y.create.l HWIO_APPS_SMMU_CB6_TLBIIPAS2L_LOW_2_APPS_ADDR A:0x61e16638
y.create.l HWIO_APPS_SMMU_CB7_TLBIIPAS2L_LOW_2_APPS_ADDR A:0x61e17638
y.create.l HWIO_APPS_SMMU_CB8_TLBIIPAS2L_LOW_2_APPS_ADDR A:0x61e18638
y.create.l HWIO_APPS_SMMU_CB9_TLBIIPAS2L_LOW_2_APPS_ADDR A:0x61e19638
y.create.l HWIO_APPS_SMMU_CB10_TLBIIPAS2L_LOW_2_APPS_ADDR A:0x61e1a638
y.create.l HWIO_APPS_SMMU_CB11_TLBIIPAS2L_LOW_2_APPS_ADDR A:0x61e1b638
y.create.l HWIO_APPS_SMMU_CB12_TLBIIPAS2L_LOW_2_APPS_ADDR A:0x61e1c638
y.create.l HWIO_APPS_SMMU_CB13_TLBIIPAS2L_LOW_2_APPS_ADDR A:0x61e1d638
y.create.l HWIO_APPS_SMMU_CB14_TLBIIPAS2L_LOW_2_APPS_ADDR A:0x61e1e638
y.create.l HWIO_APPS_SMMU_CB15_TLBIIPAS2L_LOW_2_APPS_ADDR A:0x61e1f638
y.create.l HWIO_APPS_SMMU_CB0_TLBIIPAS2L_HIGH_2_APPS_ADDR A:0x61e1063c
y.create.l HWIO_APPS_SMMU_CB1_TLBIIPAS2L_HIGH_2_APPS_ADDR A:0x61e1163c
y.create.l HWIO_APPS_SMMU_CB2_TLBIIPAS2L_HIGH_2_APPS_ADDR A:0x61e1263c
y.create.l HWIO_APPS_SMMU_CB3_TLBIIPAS2L_HIGH_2_APPS_ADDR A:0x61e1363c
y.create.l HWIO_APPS_SMMU_CB4_TLBIIPAS2L_HIGH_2_APPS_ADDR A:0x61e1463c
y.create.l HWIO_APPS_SMMU_CB5_TLBIIPAS2L_HIGH_2_APPS_ADDR A:0x61e1563c
y.create.l HWIO_APPS_SMMU_CB6_TLBIIPAS2L_HIGH_2_APPS_ADDR A:0x61e1663c
y.create.l HWIO_APPS_SMMU_CB7_TLBIIPAS2L_HIGH_2_APPS_ADDR A:0x61e1763c
y.create.l HWIO_APPS_SMMU_CB8_TLBIIPAS2L_HIGH_2_APPS_ADDR A:0x61e1863c
y.create.l HWIO_APPS_SMMU_CB9_TLBIIPAS2L_HIGH_2_APPS_ADDR A:0x61e1963c
y.create.l HWIO_APPS_SMMU_CB10_TLBIIPAS2L_HIGH_2_APPS_ADDR A:0x61e1a63c
y.create.l HWIO_APPS_SMMU_CB11_TLBIIPAS2L_HIGH_2_APPS_ADDR A:0x61e1b63c
y.create.l HWIO_APPS_SMMU_CB12_TLBIIPAS2L_HIGH_2_APPS_ADDR A:0x61e1c63c
y.create.l HWIO_APPS_SMMU_CB13_TLBIIPAS2L_HIGH_2_APPS_ADDR A:0x61e1d63c
y.create.l HWIO_APPS_SMMU_CB14_TLBIIPAS2L_HIGH_2_APPS_ADDR A:0x61e1e63c
y.create.l HWIO_APPS_SMMU_CB15_TLBIIPAS2L_HIGH_2_APPS_ADDR A:0x61e1f63c
y.create.l HWIO_APPS_SMMU_CB0_TLBSYNC_2_APPS_ADDR A:0x61e107f0
y.create.l HWIO_APPS_SMMU_CB1_TLBSYNC_2_APPS_ADDR A:0x61e117f0
y.create.l HWIO_APPS_SMMU_CB2_TLBSYNC_2_APPS_ADDR A:0x61e127f0
y.create.l HWIO_APPS_SMMU_CB3_TLBSYNC_2_APPS_ADDR A:0x61e137f0
y.create.l HWIO_APPS_SMMU_CB4_TLBSYNC_2_APPS_ADDR A:0x61e147f0
y.create.l HWIO_APPS_SMMU_CB5_TLBSYNC_2_APPS_ADDR A:0x61e157f0
y.create.l HWIO_APPS_SMMU_CB6_TLBSYNC_2_APPS_ADDR A:0x61e167f0
y.create.l HWIO_APPS_SMMU_CB7_TLBSYNC_2_APPS_ADDR A:0x61e177f0
y.create.l HWIO_APPS_SMMU_CB8_TLBSYNC_2_APPS_ADDR A:0x61e187f0
y.create.l HWIO_APPS_SMMU_CB9_TLBSYNC_2_APPS_ADDR A:0x61e197f0
y.create.l HWIO_APPS_SMMU_CB10_TLBSYNC_2_APPS_ADDR A:0x61e1a7f0
y.create.l HWIO_APPS_SMMU_CB11_TLBSYNC_2_APPS_ADDR A:0x61e1b7f0
y.create.l HWIO_APPS_SMMU_CB12_TLBSYNC_2_APPS_ADDR A:0x61e1c7f0
y.create.l HWIO_APPS_SMMU_CB13_TLBSYNC_2_APPS_ADDR A:0x61e1d7f0
y.create.l HWIO_APPS_SMMU_CB14_TLBSYNC_2_APPS_ADDR A:0x61e1e7f0
y.create.l HWIO_APPS_SMMU_CB15_TLBSYNC_2_APPS_ADDR A:0x61e1f7f0
y.create.l HWIO_APPS_SMMU_CB0_TLBSTATUS_2_APPS_ADDR A:0x61e107f4
y.create.l HWIO_APPS_SMMU_CB1_TLBSTATUS_2_APPS_ADDR A:0x61e117f4
y.create.l HWIO_APPS_SMMU_CB2_TLBSTATUS_2_APPS_ADDR A:0x61e127f4
y.create.l HWIO_APPS_SMMU_CB3_TLBSTATUS_2_APPS_ADDR A:0x61e137f4
y.create.l HWIO_APPS_SMMU_CB4_TLBSTATUS_2_APPS_ADDR A:0x61e147f4
y.create.l HWIO_APPS_SMMU_CB5_TLBSTATUS_2_APPS_ADDR A:0x61e157f4
y.create.l HWIO_APPS_SMMU_CB6_TLBSTATUS_2_APPS_ADDR A:0x61e167f4
y.create.l HWIO_APPS_SMMU_CB7_TLBSTATUS_2_APPS_ADDR A:0x61e177f4
y.create.l HWIO_APPS_SMMU_CB8_TLBSTATUS_2_APPS_ADDR A:0x61e187f4
y.create.l HWIO_APPS_SMMU_CB9_TLBSTATUS_2_APPS_ADDR A:0x61e197f4
y.create.l HWIO_APPS_SMMU_CB10_TLBSTATUS_2_APPS_ADDR A:0x61e1a7f4
y.create.l HWIO_APPS_SMMU_CB11_TLBSTATUS_2_APPS_ADDR A:0x61e1b7f4
y.create.l HWIO_APPS_SMMU_CB12_TLBSTATUS_2_APPS_ADDR A:0x61e1c7f4
y.create.l HWIO_APPS_SMMU_CB13_TLBSTATUS_2_APPS_ADDR A:0x61e1d7f4
y.create.l HWIO_APPS_SMMU_CB14_TLBSTATUS_2_APPS_ADDR A:0x61e1e7f4
y.create.l HWIO_APPS_SMMU_CB15_TLBSTATUS_2_APPS_ADDR A:0x61e1f7f4
y.create.l HWIO_APPS_SMMU_CB0_PMEVCNTR0_2_APPS_ADDR A:0x61e10e00
y.create.l HWIO_APPS_SMMU_CB1_PMEVCNTR0_2_APPS_ADDR A:0x61e11e00
y.create.l HWIO_APPS_SMMU_CB2_PMEVCNTR0_2_APPS_ADDR A:0x61e12e00
y.create.l HWIO_APPS_SMMU_CB3_PMEVCNTR0_2_APPS_ADDR A:0x61e13e00
y.create.l HWIO_APPS_SMMU_CB4_PMEVCNTR0_2_APPS_ADDR A:0x61e14e00
y.create.l HWIO_APPS_SMMU_CB5_PMEVCNTR0_2_APPS_ADDR A:0x61e15e00
y.create.l HWIO_APPS_SMMU_CB6_PMEVCNTR0_2_APPS_ADDR A:0x61e16e00
y.create.l HWIO_APPS_SMMU_CB7_PMEVCNTR0_2_APPS_ADDR A:0x61e17e00
y.create.l HWIO_APPS_SMMU_CB8_PMEVCNTR0_2_APPS_ADDR A:0x61e18e00
y.create.l HWIO_APPS_SMMU_CB9_PMEVCNTR0_2_APPS_ADDR A:0x61e19e00
y.create.l HWIO_APPS_SMMU_CB10_PMEVCNTR0_2_APPS_ADDR A:0x61e1ae00
y.create.l HWIO_APPS_SMMU_CB11_PMEVCNTR0_2_APPS_ADDR A:0x61e1be00
y.create.l HWIO_APPS_SMMU_CB12_PMEVCNTR0_2_APPS_ADDR A:0x61e1ce00
y.create.l HWIO_APPS_SMMU_CB13_PMEVCNTR0_2_APPS_ADDR A:0x61e1de00
y.create.l HWIO_APPS_SMMU_CB14_PMEVCNTR0_2_APPS_ADDR A:0x61e1ee00
y.create.l HWIO_APPS_SMMU_CB15_PMEVCNTR0_2_APPS_ADDR A:0x61e1fe00
y.create.l HWIO_APPS_SMMU_CB0_PMEVCNTR1_2_APPS_ADDR A:0x61e10e04
y.create.l HWIO_APPS_SMMU_CB1_PMEVCNTR1_2_APPS_ADDR A:0x61e11e04
y.create.l HWIO_APPS_SMMU_CB2_PMEVCNTR1_2_APPS_ADDR A:0x61e12e04
y.create.l HWIO_APPS_SMMU_CB3_PMEVCNTR1_2_APPS_ADDR A:0x61e13e04
y.create.l HWIO_APPS_SMMU_CB4_PMEVCNTR1_2_APPS_ADDR A:0x61e14e04
y.create.l HWIO_APPS_SMMU_CB5_PMEVCNTR1_2_APPS_ADDR A:0x61e15e04
y.create.l HWIO_APPS_SMMU_CB6_PMEVCNTR1_2_APPS_ADDR A:0x61e16e04
y.create.l HWIO_APPS_SMMU_CB7_PMEVCNTR1_2_APPS_ADDR A:0x61e17e04
y.create.l HWIO_APPS_SMMU_CB8_PMEVCNTR1_2_APPS_ADDR A:0x61e18e04
y.create.l HWIO_APPS_SMMU_CB9_PMEVCNTR1_2_APPS_ADDR A:0x61e19e04
y.create.l HWIO_APPS_SMMU_CB10_PMEVCNTR1_2_APPS_ADDR A:0x61e1ae04
y.create.l HWIO_APPS_SMMU_CB11_PMEVCNTR1_2_APPS_ADDR A:0x61e1be04
y.create.l HWIO_APPS_SMMU_CB12_PMEVCNTR1_2_APPS_ADDR A:0x61e1ce04
y.create.l HWIO_APPS_SMMU_CB13_PMEVCNTR1_2_APPS_ADDR A:0x61e1de04
y.create.l HWIO_APPS_SMMU_CB14_PMEVCNTR1_2_APPS_ADDR A:0x61e1ee04
y.create.l HWIO_APPS_SMMU_CB15_PMEVCNTR1_2_APPS_ADDR A:0x61e1fe04
y.create.l HWIO_APPS_SMMU_CB0_PMEVCNTR2_2_APPS_ADDR A:0x61e10e08
y.create.l HWIO_APPS_SMMU_CB1_PMEVCNTR2_2_APPS_ADDR A:0x61e11e08
y.create.l HWIO_APPS_SMMU_CB2_PMEVCNTR2_2_APPS_ADDR A:0x61e12e08
y.create.l HWIO_APPS_SMMU_CB3_PMEVCNTR2_2_APPS_ADDR A:0x61e13e08
y.create.l HWIO_APPS_SMMU_CB4_PMEVCNTR2_2_APPS_ADDR A:0x61e14e08
y.create.l HWIO_APPS_SMMU_CB5_PMEVCNTR2_2_APPS_ADDR A:0x61e15e08
y.create.l HWIO_APPS_SMMU_CB6_PMEVCNTR2_2_APPS_ADDR A:0x61e16e08
y.create.l HWIO_APPS_SMMU_CB7_PMEVCNTR2_2_APPS_ADDR A:0x61e17e08
y.create.l HWIO_APPS_SMMU_CB8_PMEVCNTR2_2_APPS_ADDR A:0x61e18e08
y.create.l HWIO_APPS_SMMU_CB9_PMEVCNTR2_2_APPS_ADDR A:0x61e19e08
y.create.l HWIO_APPS_SMMU_CB10_PMEVCNTR2_2_APPS_ADDR A:0x61e1ae08
y.create.l HWIO_APPS_SMMU_CB11_PMEVCNTR2_2_APPS_ADDR A:0x61e1be08
y.create.l HWIO_APPS_SMMU_CB12_PMEVCNTR2_2_APPS_ADDR A:0x61e1ce08
y.create.l HWIO_APPS_SMMU_CB13_PMEVCNTR2_2_APPS_ADDR A:0x61e1de08
y.create.l HWIO_APPS_SMMU_CB14_PMEVCNTR2_2_APPS_ADDR A:0x61e1ee08
y.create.l HWIO_APPS_SMMU_CB15_PMEVCNTR2_2_APPS_ADDR A:0x61e1fe08
y.create.l HWIO_APPS_SMMU_CB0_PMEVCNTR3_2_APPS_ADDR A:0x61e10e0c
y.create.l HWIO_APPS_SMMU_CB1_PMEVCNTR3_2_APPS_ADDR A:0x61e11e0c
y.create.l HWIO_APPS_SMMU_CB2_PMEVCNTR3_2_APPS_ADDR A:0x61e12e0c
y.create.l HWIO_APPS_SMMU_CB3_PMEVCNTR3_2_APPS_ADDR A:0x61e13e0c
y.create.l HWIO_APPS_SMMU_CB4_PMEVCNTR3_2_APPS_ADDR A:0x61e14e0c
y.create.l HWIO_APPS_SMMU_CB5_PMEVCNTR3_2_APPS_ADDR A:0x61e15e0c
y.create.l HWIO_APPS_SMMU_CB6_PMEVCNTR3_2_APPS_ADDR A:0x61e16e0c
y.create.l HWIO_APPS_SMMU_CB7_PMEVCNTR3_2_APPS_ADDR A:0x61e17e0c
y.create.l HWIO_APPS_SMMU_CB8_PMEVCNTR3_2_APPS_ADDR A:0x61e18e0c
y.create.l HWIO_APPS_SMMU_CB9_PMEVCNTR3_2_APPS_ADDR A:0x61e19e0c
y.create.l HWIO_APPS_SMMU_CB10_PMEVCNTR3_2_APPS_ADDR A:0x61e1ae0c
y.create.l HWIO_APPS_SMMU_CB11_PMEVCNTR3_2_APPS_ADDR A:0x61e1be0c
y.create.l HWIO_APPS_SMMU_CB12_PMEVCNTR3_2_APPS_ADDR A:0x61e1ce0c
y.create.l HWIO_APPS_SMMU_CB13_PMEVCNTR3_2_APPS_ADDR A:0x61e1de0c
y.create.l HWIO_APPS_SMMU_CB14_PMEVCNTR3_2_APPS_ADDR A:0x61e1ee0c
y.create.l HWIO_APPS_SMMU_CB15_PMEVCNTR3_2_APPS_ADDR A:0x61e1fe0c
y.create.l HWIO_APPS_SMMU_CB0_PMEVTYPER0_2_APPS_ADDR A:0x61e10e80
y.create.l HWIO_APPS_SMMU_CB1_PMEVTYPER0_2_APPS_ADDR A:0x61e11e80
y.create.l HWIO_APPS_SMMU_CB2_PMEVTYPER0_2_APPS_ADDR A:0x61e12e80
y.create.l HWIO_APPS_SMMU_CB3_PMEVTYPER0_2_APPS_ADDR A:0x61e13e80
y.create.l HWIO_APPS_SMMU_CB4_PMEVTYPER0_2_APPS_ADDR A:0x61e14e80
y.create.l HWIO_APPS_SMMU_CB5_PMEVTYPER0_2_APPS_ADDR A:0x61e15e80
y.create.l HWIO_APPS_SMMU_CB6_PMEVTYPER0_2_APPS_ADDR A:0x61e16e80
y.create.l HWIO_APPS_SMMU_CB7_PMEVTYPER0_2_APPS_ADDR A:0x61e17e80
y.create.l HWIO_APPS_SMMU_CB8_PMEVTYPER0_2_APPS_ADDR A:0x61e18e80
y.create.l HWIO_APPS_SMMU_CB9_PMEVTYPER0_2_APPS_ADDR A:0x61e19e80
y.create.l HWIO_APPS_SMMU_CB10_PMEVTYPER0_2_APPS_ADDR A:0x61e1ae80
y.create.l HWIO_APPS_SMMU_CB11_PMEVTYPER0_2_APPS_ADDR A:0x61e1be80
y.create.l HWIO_APPS_SMMU_CB12_PMEVTYPER0_2_APPS_ADDR A:0x61e1ce80
y.create.l HWIO_APPS_SMMU_CB13_PMEVTYPER0_2_APPS_ADDR A:0x61e1de80
y.create.l HWIO_APPS_SMMU_CB14_PMEVTYPER0_2_APPS_ADDR A:0x61e1ee80
y.create.l HWIO_APPS_SMMU_CB15_PMEVTYPER0_2_APPS_ADDR A:0x61e1fe80
y.create.l HWIO_APPS_SMMU_CB0_PMEVTYPER1_2_APPS_ADDR A:0x61e10e84
y.create.l HWIO_APPS_SMMU_CB1_PMEVTYPER1_2_APPS_ADDR A:0x61e11e84
y.create.l HWIO_APPS_SMMU_CB2_PMEVTYPER1_2_APPS_ADDR A:0x61e12e84
y.create.l HWIO_APPS_SMMU_CB3_PMEVTYPER1_2_APPS_ADDR A:0x61e13e84
y.create.l HWIO_APPS_SMMU_CB4_PMEVTYPER1_2_APPS_ADDR A:0x61e14e84
y.create.l HWIO_APPS_SMMU_CB5_PMEVTYPER1_2_APPS_ADDR A:0x61e15e84
y.create.l HWIO_APPS_SMMU_CB6_PMEVTYPER1_2_APPS_ADDR A:0x61e16e84
y.create.l HWIO_APPS_SMMU_CB7_PMEVTYPER1_2_APPS_ADDR A:0x61e17e84
y.create.l HWIO_APPS_SMMU_CB8_PMEVTYPER1_2_APPS_ADDR A:0x61e18e84
y.create.l HWIO_APPS_SMMU_CB9_PMEVTYPER1_2_APPS_ADDR A:0x61e19e84
y.create.l HWIO_APPS_SMMU_CB10_PMEVTYPER1_2_APPS_ADDR A:0x61e1ae84
y.create.l HWIO_APPS_SMMU_CB11_PMEVTYPER1_2_APPS_ADDR A:0x61e1be84
y.create.l HWIO_APPS_SMMU_CB12_PMEVTYPER1_2_APPS_ADDR A:0x61e1ce84
y.create.l HWIO_APPS_SMMU_CB13_PMEVTYPER1_2_APPS_ADDR A:0x61e1de84
y.create.l HWIO_APPS_SMMU_CB14_PMEVTYPER1_2_APPS_ADDR A:0x61e1ee84
y.create.l HWIO_APPS_SMMU_CB15_PMEVTYPER1_2_APPS_ADDR A:0x61e1fe84
y.create.l HWIO_APPS_SMMU_CB0_PMEVTYPER2_2_APPS_ADDR A:0x61e10e88
y.create.l HWIO_APPS_SMMU_CB1_PMEVTYPER2_2_APPS_ADDR A:0x61e11e88
y.create.l HWIO_APPS_SMMU_CB2_PMEVTYPER2_2_APPS_ADDR A:0x61e12e88
y.create.l HWIO_APPS_SMMU_CB3_PMEVTYPER2_2_APPS_ADDR A:0x61e13e88
y.create.l HWIO_APPS_SMMU_CB4_PMEVTYPER2_2_APPS_ADDR A:0x61e14e88
y.create.l HWIO_APPS_SMMU_CB5_PMEVTYPER2_2_APPS_ADDR A:0x61e15e88
y.create.l HWIO_APPS_SMMU_CB6_PMEVTYPER2_2_APPS_ADDR A:0x61e16e88
y.create.l HWIO_APPS_SMMU_CB7_PMEVTYPER2_2_APPS_ADDR A:0x61e17e88
y.create.l HWIO_APPS_SMMU_CB8_PMEVTYPER2_2_APPS_ADDR A:0x61e18e88
y.create.l HWIO_APPS_SMMU_CB9_PMEVTYPER2_2_APPS_ADDR A:0x61e19e88
y.create.l HWIO_APPS_SMMU_CB10_PMEVTYPER2_2_APPS_ADDR A:0x61e1ae88
y.create.l HWIO_APPS_SMMU_CB11_PMEVTYPER2_2_APPS_ADDR A:0x61e1be88
y.create.l HWIO_APPS_SMMU_CB12_PMEVTYPER2_2_APPS_ADDR A:0x61e1ce88
y.create.l HWIO_APPS_SMMU_CB13_PMEVTYPER2_2_APPS_ADDR A:0x61e1de88
y.create.l HWIO_APPS_SMMU_CB14_PMEVTYPER2_2_APPS_ADDR A:0x61e1ee88
y.create.l HWIO_APPS_SMMU_CB15_PMEVTYPER2_2_APPS_ADDR A:0x61e1fe88
y.create.l HWIO_APPS_SMMU_CB0_PMEVTYPER3_2_APPS_ADDR A:0x61e10e8c
y.create.l HWIO_APPS_SMMU_CB1_PMEVTYPER3_2_APPS_ADDR A:0x61e11e8c
y.create.l HWIO_APPS_SMMU_CB2_PMEVTYPER3_2_APPS_ADDR A:0x61e12e8c
y.create.l HWIO_APPS_SMMU_CB3_PMEVTYPER3_2_APPS_ADDR A:0x61e13e8c
y.create.l HWIO_APPS_SMMU_CB4_PMEVTYPER3_2_APPS_ADDR A:0x61e14e8c
y.create.l HWIO_APPS_SMMU_CB5_PMEVTYPER3_2_APPS_ADDR A:0x61e15e8c
y.create.l HWIO_APPS_SMMU_CB6_PMEVTYPER3_2_APPS_ADDR A:0x61e16e8c
y.create.l HWIO_APPS_SMMU_CB7_PMEVTYPER3_2_APPS_ADDR A:0x61e17e8c
y.create.l HWIO_APPS_SMMU_CB8_PMEVTYPER3_2_APPS_ADDR A:0x61e18e8c
y.create.l HWIO_APPS_SMMU_CB9_PMEVTYPER3_2_APPS_ADDR A:0x61e19e8c
y.create.l HWIO_APPS_SMMU_CB10_PMEVTYPER3_2_APPS_ADDR A:0x61e1ae8c
y.create.l HWIO_APPS_SMMU_CB11_PMEVTYPER3_2_APPS_ADDR A:0x61e1be8c
y.create.l HWIO_APPS_SMMU_CB12_PMEVTYPER3_2_APPS_ADDR A:0x61e1ce8c
y.create.l HWIO_APPS_SMMU_CB13_PMEVTYPER3_2_APPS_ADDR A:0x61e1de8c
y.create.l HWIO_APPS_SMMU_CB14_PMEVTYPER3_2_APPS_ADDR A:0x61e1ee8c
y.create.l HWIO_APPS_SMMU_CB15_PMEVTYPER3_2_APPS_ADDR A:0x61e1fe8c
y.create.l HWIO_APPS_SMMU_CB0_PMCFGR_2_APPS_ADDR A:0x61e10f00
y.create.l HWIO_APPS_SMMU_CB1_PMCFGR_2_APPS_ADDR A:0x61e11f00
y.create.l HWIO_APPS_SMMU_CB2_PMCFGR_2_APPS_ADDR A:0x61e12f00
y.create.l HWIO_APPS_SMMU_CB3_PMCFGR_2_APPS_ADDR A:0x61e13f00
y.create.l HWIO_APPS_SMMU_CB4_PMCFGR_2_APPS_ADDR A:0x61e14f00
y.create.l HWIO_APPS_SMMU_CB5_PMCFGR_2_APPS_ADDR A:0x61e15f00
y.create.l HWIO_APPS_SMMU_CB6_PMCFGR_2_APPS_ADDR A:0x61e16f00
y.create.l HWIO_APPS_SMMU_CB7_PMCFGR_2_APPS_ADDR A:0x61e17f00
y.create.l HWIO_APPS_SMMU_CB8_PMCFGR_2_APPS_ADDR A:0x61e18f00
y.create.l HWIO_APPS_SMMU_CB9_PMCFGR_2_APPS_ADDR A:0x61e19f00
y.create.l HWIO_APPS_SMMU_CB10_PMCFGR_2_APPS_ADDR A:0x61e1af00
y.create.l HWIO_APPS_SMMU_CB11_PMCFGR_2_APPS_ADDR A:0x61e1bf00
y.create.l HWIO_APPS_SMMU_CB12_PMCFGR_2_APPS_ADDR A:0x61e1cf00
y.create.l HWIO_APPS_SMMU_CB13_PMCFGR_2_APPS_ADDR A:0x61e1df00
y.create.l HWIO_APPS_SMMU_CB14_PMCFGR_2_APPS_ADDR A:0x61e1ef00
y.create.l HWIO_APPS_SMMU_CB15_PMCFGR_2_APPS_ADDR A:0x61e1ff00
y.create.l HWIO_APPS_SMMU_CB0_PMCR_2_APPS_ADDR A:0x61e10f04
y.create.l HWIO_APPS_SMMU_CB1_PMCR_2_APPS_ADDR A:0x61e11f04
y.create.l HWIO_APPS_SMMU_CB2_PMCR_2_APPS_ADDR A:0x61e12f04
y.create.l HWIO_APPS_SMMU_CB3_PMCR_2_APPS_ADDR A:0x61e13f04
y.create.l HWIO_APPS_SMMU_CB4_PMCR_2_APPS_ADDR A:0x61e14f04
y.create.l HWIO_APPS_SMMU_CB5_PMCR_2_APPS_ADDR A:0x61e15f04
y.create.l HWIO_APPS_SMMU_CB6_PMCR_2_APPS_ADDR A:0x61e16f04
y.create.l HWIO_APPS_SMMU_CB7_PMCR_2_APPS_ADDR A:0x61e17f04
y.create.l HWIO_APPS_SMMU_CB8_PMCR_2_APPS_ADDR A:0x61e18f04
y.create.l HWIO_APPS_SMMU_CB9_PMCR_2_APPS_ADDR A:0x61e19f04
y.create.l HWIO_APPS_SMMU_CB10_PMCR_2_APPS_ADDR A:0x61e1af04
y.create.l HWIO_APPS_SMMU_CB11_PMCR_2_APPS_ADDR A:0x61e1bf04
y.create.l HWIO_APPS_SMMU_CB12_PMCR_2_APPS_ADDR A:0x61e1cf04
y.create.l HWIO_APPS_SMMU_CB13_PMCR_2_APPS_ADDR A:0x61e1df04
y.create.l HWIO_APPS_SMMU_CB14_PMCR_2_APPS_ADDR A:0x61e1ef04
y.create.l HWIO_APPS_SMMU_CB15_PMCR_2_APPS_ADDR A:0x61e1ff04
y.create.l HWIO_APPS_SMMU_CB0_PMCEID_2_APPS_ADDR A:0x61e10f20
y.create.l HWIO_APPS_SMMU_CB1_PMCEID_2_APPS_ADDR A:0x61e11f20
y.create.l HWIO_APPS_SMMU_CB2_PMCEID_2_APPS_ADDR A:0x61e12f20
y.create.l HWIO_APPS_SMMU_CB3_PMCEID_2_APPS_ADDR A:0x61e13f20
y.create.l HWIO_APPS_SMMU_CB4_PMCEID_2_APPS_ADDR A:0x61e14f20
y.create.l HWIO_APPS_SMMU_CB5_PMCEID_2_APPS_ADDR A:0x61e15f20
y.create.l HWIO_APPS_SMMU_CB6_PMCEID_2_APPS_ADDR A:0x61e16f20
y.create.l HWIO_APPS_SMMU_CB7_PMCEID_2_APPS_ADDR A:0x61e17f20
y.create.l HWIO_APPS_SMMU_CB8_PMCEID_2_APPS_ADDR A:0x61e18f20
y.create.l HWIO_APPS_SMMU_CB9_PMCEID_2_APPS_ADDR A:0x61e19f20
y.create.l HWIO_APPS_SMMU_CB10_PMCEID_2_APPS_ADDR A:0x61e1af20
y.create.l HWIO_APPS_SMMU_CB11_PMCEID_2_APPS_ADDR A:0x61e1bf20
y.create.l HWIO_APPS_SMMU_CB12_PMCEID_2_APPS_ADDR A:0x61e1cf20
y.create.l HWIO_APPS_SMMU_CB13_PMCEID_2_APPS_ADDR A:0x61e1df20
y.create.l HWIO_APPS_SMMU_CB14_PMCEID_2_APPS_ADDR A:0x61e1ef20
y.create.l HWIO_APPS_SMMU_CB15_PMCEID_2_APPS_ADDR A:0x61e1ff20
y.create.l HWIO_APPS_SMMU_CB0_PMCNTENSE_2_APPS_ADDR A:0x61e10f40
y.create.l HWIO_APPS_SMMU_CB1_PMCNTENSE_2_APPS_ADDR A:0x61e11f40
y.create.l HWIO_APPS_SMMU_CB2_PMCNTENSE_2_APPS_ADDR A:0x61e12f40
y.create.l HWIO_APPS_SMMU_CB3_PMCNTENSE_2_APPS_ADDR A:0x61e13f40
y.create.l HWIO_APPS_SMMU_CB4_PMCNTENSE_2_APPS_ADDR A:0x61e14f40
y.create.l HWIO_APPS_SMMU_CB5_PMCNTENSE_2_APPS_ADDR A:0x61e15f40
y.create.l HWIO_APPS_SMMU_CB6_PMCNTENSE_2_APPS_ADDR A:0x61e16f40
y.create.l HWIO_APPS_SMMU_CB7_PMCNTENSE_2_APPS_ADDR A:0x61e17f40
y.create.l HWIO_APPS_SMMU_CB8_PMCNTENSE_2_APPS_ADDR A:0x61e18f40
y.create.l HWIO_APPS_SMMU_CB9_PMCNTENSE_2_APPS_ADDR A:0x61e19f40
y.create.l HWIO_APPS_SMMU_CB10_PMCNTENSE_2_APPS_ADDR A:0x61e1af40
y.create.l HWIO_APPS_SMMU_CB11_PMCNTENSE_2_APPS_ADDR A:0x61e1bf40
y.create.l HWIO_APPS_SMMU_CB12_PMCNTENSE_2_APPS_ADDR A:0x61e1cf40
y.create.l HWIO_APPS_SMMU_CB13_PMCNTENSE_2_APPS_ADDR A:0x61e1df40
y.create.l HWIO_APPS_SMMU_CB14_PMCNTENSE_2_APPS_ADDR A:0x61e1ef40
y.create.l HWIO_APPS_SMMU_CB15_PMCNTENSE_2_APPS_ADDR A:0x61e1ff40
y.create.l HWIO_APPS_SMMU_CB0_PMCNTENCLR_2_APPS_ADDR A:0x61e10f44
y.create.l HWIO_APPS_SMMU_CB1_PMCNTENCLR_2_APPS_ADDR A:0x61e11f44
y.create.l HWIO_APPS_SMMU_CB2_PMCNTENCLR_2_APPS_ADDR A:0x61e12f44
y.create.l HWIO_APPS_SMMU_CB3_PMCNTENCLR_2_APPS_ADDR A:0x61e13f44
y.create.l HWIO_APPS_SMMU_CB4_PMCNTENCLR_2_APPS_ADDR A:0x61e14f44
y.create.l HWIO_APPS_SMMU_CB5_PMCNTENCLR_2_APPS_ADDR A:0x61e15f44
y.create.l HWIO_APPS_SMMU_CB6_PMCNTENCLR_2_APPS_ADDR A:0x61e16f44
y.create.l HWIO_APPS_SMMU_CB7_PMCNTENCLR_2_APPS_ADDR A:0x61e17f44
y.create.l HWIO_APPS_SMMU_CB8_PMCNTENCLR_2_APPS_ADDR A:0x61e18f44
y.create.l HWIO_APPS_SMMU_CB9_PMCNTENCLR_2_APPS_ADDR A:0x61e19f44
y.create.l HWIO_APPS_SMMU_CB10_PMCNTENCLR_2_APPS_ADDR A:0x61e1af44
y.create.l HWIO_APPS_SMMU_CB11_PMCNTENCLR_2_APPS_ADDR A:0x61e1bf44
y.create.l HWIO_APPS_SMMU_CB12_PMCNTENCLR_2_APPS_ADDR A:0x61e1cf44
y.create.l HWIO_APPS_SMMU_CB13_PMCNTENCLR_2_APPS_ADDR A:0x61e1df44
y.create.l HWIO_APPS_SMMU_CB14_PMCNTENCLR_2_APPS_ADDR A:0x61e1ef44
y.create.l HWIO_APPS_SMMU_CB15_PMCNTENCLR_2_APPS_ADDR A:0x61e1ff44
y.create.l HWIO_APPS_SMMU_CB0_PMCNTENSET_2_APPS_ADDR A:0x61e10f48
y.create.l HWIO_APPS_SMMU_CB1_PMCNTENSET_2_APPS_ADDR A:0x61e11f48
y.create.l HWIO_APPS_SMMU_CB2_PMCNTENSET_2_APPS_ADDR A:0x61e12f48
y.create.l HWIO_APPS_SMMU_CB3_PMCNTENSET_2_APPS_ADDR A:0x61e13f48
y.create.l HWIO_APPS_SMMU_CB4_PMCNTENSET_2_APPS_ADDR A:0x61e14f48
y.create.l HWIO_APPS_SMMU_CB5_PMCNTENSET_2_APPS_ADDR A:0x61e15f48
y.create.l HWIO_APPS_SMMU_CB6_PMCNTENSET_2_APPS_ADDR A:0x61e16f48
y.create.l HWIO_APPS_SMMU_CB7_PMCNTENSET_2_APPS_ADDR A:0x61e17f48
y.create.l HWIO_APPS_SMMU_CB8_PMCNTENSET_2_APPS_ADDR A:0x61e18f48
y.create.l HWIO_APPS_SMMU_CB9_PMCNTENSET_2_APPS_ADDR A:0x61e19f48
y.create.l HWIO_APPS_SMMU_CB10_PMCNTENSET_2_APPS_ADDR A:0x61e1af48
y.create.l HWIO_APPS_SMMU_CB11_PMCNTENSET_2_APPS_ADDR A:0x61e1bf48
y.create.l HWIO_APPS_SMMU_CB12_PMCNTENSET_2_APPS_ADDR A:0x61e1cf48
y.create.l HWIO_APPS_SMMU_CB13_PMCNTENSET_2_APPS_ADDR A:0x61e1df48
y.create.l HWIO_APPS_SMMU_CB14_PMCNTENSET_2_APPS_ADDR A:0x61e1ef48
y.create.l HWIO_APPS_SMMU_CB15_PMCNTENSET_2_APPS_ADDR A:0x61e1ff48
y.create.l HWIO_APPS_SMMU_CB0_PMINTENCLR_2_APPS_ADDR A:0x61e10f4c
y.create.l HWIO_APPS_SMMU_CB1_PMINTENCLR_2_APPS_ADDR A:0x61e11f4c
y.create.l HWIO_APPS_SMMU_CB2_PMINTENCLR_2_APPS_ADDR A:0x61e12f4c
y.create.l HWIO_APPS_SMMU_CB3_PMINTENCLR_2_APPS_ADDR A:0x61e13f4c
y.create.l HWIO_APPS_SMMU_CB4_PMINTENCLR_2_APPS_ADDR A:0x61e14f4c
y.create.l HWIO_APPS_SMMU_CB5_PMINTENCLR_2_APPS_ADDR A:0x61e15f4c
y.create.l HWIO_APPS_SMMU_CB6_PMINTENCLR_2_APPS_ADDR A:0x61e16f4c
y.create.l HWIO_APPS_SMMU_CB7_PMINTENCLR_2_APPS_ADDR A:0x61e17f4c
y.create.l HWIO_APPS_SMMU_CB8_PMINTENCLR_2_APPS_ADDR A:0x61e18f4c
y.create.l HWIO_APPS_SMMU_CB9_PMINTENCLR_2_APPS_ADDR A:0x61e19f4c
y.create.l HWIO_APPS_SMMU_CB10_PMINTENCLR_2_APPS_ADDR A:0x61e1af4c
y.create.l HWIO_APPS_SMMU_CB11_PMINTENCLR_2_APPS_ADDR A:0x61e1bf4c
y.create.l HWIO_APPS_SMMU_CB12_PMINTENCLR_2_APPS_ADDR A:0x61e1cf4c
y.create.l HWIO_APPS_SMMU_CB13_PMINTENCLR_2_APPS_ADDR A:0x61e1df4c
y.create.l HWIO_APPS_SMMU_CB14_PMINTENCLR_2_APPS_ADDR A:0x61e1ef4c
y.create.l HWIO_APPS_SMMU_CB15_PMINTENCLR_2_APPS_ADDR A:0x61e1ff4c
y.create.l HWIO_APPS_SMMU_CB0_PMOVSCLR_2_APPS_ADDR A:0x61e10f50
y.create.l HWIO_APPS_SMMU_CB1_PMOVSCLR_2_APPS_ADDR A:0x61e11f50
y.create.l HWIO_APPS_SMMU_CB2_PMOVSCLR_2_APPS_ADDR A:0x61e12f50
y.create.l HWIO_APPS_SMMU_CB3_PMOVSCLR_2_APPS_ADDR A:0x61e13f50
y.create.l HWIO_APPS_SMMU_CB4_PMOVSCLR_2_APPS_ADDR A:0x61e14f50
y.create.l HWIO_APPS_SMMU_CB5_PMOVSCLR_2_APPS_ADDR A:0x61e15f50
y.create.l HWIO_APPS_SMMU_CB6_PMOVSCLR_2_APPS_ADDR A:0x61e16f50
y.create.l HWIO_APPS_SMMU_CB7_PMOVSCLR_2_APPS_ADDR A:0x61e17f50
y.create.l HWIO_APPS_SMMU_CB8_PMOVSCLR_2_APPS_ADDR A:0x61e18f50
y.create.l HWIO_APPS_SMMU_CB9_PMOVSCLR_2_APPS_ADDR A:0x61e19f50
y.create.l HWIO_APPS_SMMU_CB10_PMOVSCLR_2_APPS_ADDR A:0x61e1af50
y.create.l HWIO_APPS_SMMU_CB11_PMOVSCLR_2_APPS_ADDR A:0x61e1bf50
y.create.l HWIO_APPS_SMMU_CB12_PMOVSCLR_2_APPS_ADDR A:0x61e1cf50
y.create.l HWIO_APPS_SMMU_CB13_PMOVSCLR_2_APPS_ADDR A:0x61e1df50
y.create.l HWIO_APPS_SMMU_CB14_PMOVSCLR_2_APPS_ADDR A:0x61e1ef50
y.create.l HWIO_APPS_SMMU_CB15_PMOVSCLR_2_APPS_ADDR A:0x61e1ff50
y.create.l HWIO_APPS_SMMU_CB0_PMOVSSET_2_APPS_ADDR A:0x61e10f58
y.create.l HWIO_APPS_SMMU_CB1_PMOVSSET_2_APPS_ADDR A:0x61e11f58
y.create.l HWIO_APPS_SMMU_CB2_PMOVSSET_2_APPS_ADDR A:0x61e12f58
y.create.l HWIO_APPS_SMMU_CB3_PMOVSSET_2_APPS_ADDR A:0x61e13f58
y.create.l HWIO_APPS_SMMU_CB4_PMOVSSET_2_APPS_ADDR A:0x61e14f58
y.create.l HWIO_APPS_SMMU_CB5_PMOVSSET_2_APPS_ADDR A:0x61e15f58
y.create.l HWIO_APPS_SMMU_CB6_PMOVSSET_2_APPS_ADDR A:0x61e16f58
y.create.l HWIO_APPS_SMMU_CB7_PMOVSSET_2_APPS_ADDR A:0x61e17f58
y.create.l HWIO_APPS_SMMU_CB8_PMOVSSET_2_APPS_ADDR A:0x61e18f58
y.create.l HWIO_APPS_SMMU_CB9_PMOVSSET_2_APPS_ADDR A:0x61e19f58
y.create.l HWIO_APPS_SMMU_CB10_PMOVSSET_2_APPS_ADDR A:0x61e1af58
y.create.l HWIO_APPS_SMMU_CB11_PMOVSSET_2_APPS_ADDR A:0x61e1bf58
y.create.l HWIO_APPS_SMMU_CB12_PMOVSSET_2_APPS_ADDR A:0x61e1cf58
y.create.l HWIO_APPS_SMMU_CB13_PMOVSSET_2_APPS_ADDR A:0x61e1df58
y.create.l HWIO_APPS_SMMU_CB14_PMOVSSET_2_APPS_ADDR A:0x61e1ef58
y.create.l HWIO_APPS_SMMU_CB15_PMOVSSET_2_APPS_ADDR A:0x61e1ff58
y.create.l HWIO_APPS_SMMU_CB0_PMAUTHSTATUS_2_APPS_ADDR A:0x61e10fb8
y.create.l HWIO_APPS_SMMU_CB1_PMAUTHSTATUS_2_APPS_ADDR A:0x61e11fb8
y.create.l HWIO_APPS_SMMU_CB2_PMAUTHSTATUS_2_APPS_ADDR A:0x61e12fb8
y.create.l HWIO_APPS_SMMU_CB3_PMAUTHSTATUS_2_APPS_ADDR A:0x61e13fb8
y.create.l HWIO_APPS_SMMU_CB4_PMAUTHSTATUS_2_APPS_ADDR A:0x61e14fb8
y.create.l HWIO_APPS_SMMU_CB5_PMAUTHSTATUS_2_APPS_ADDR A:0x61e15fb8
y.create.l HWIO_APPS_SMMU_CB6_PMAUTHSTATUS_2_APPS_ADDR A:0x61e16fb8
y.create.l HWIO_APPS_SMMU_CB7_PMAUTHSTATUS_2_APPS_ADDR A:0x61e17fb8
y.create.l HWIO_APPS_SMMU_CB8_PMAUTHSTATUS_2_APPS_ADDR A:0x61e18fb8
y.create.l HWIO_APPS_SMMU_CB9_PMAUTHSTATUS_2_APPS_ADDR A:0x61e19fb8
y.create.l HWIO_APPS_SMMU_CB10_PMAUTHSTATUS_2_APPS_ADDR A:0x61e1afb8
y.create.l HWIO_APPS_SMMU_CB11_PMAUTHSTATUS_2_APPS_ADDR A:0x61e1bfb8
y.create.l HWIO_APPS_SMMU_CB12_PMAUTHSTATUS_2_APPS_ADDR A:0x61e1cfb8
y.create.l HWIO_APPS_SMMU_CB13_PMAUTHSTATUS_2_APPS_ADDR A:0x61e1dfb8
y.create.l HWIO_APPS_SMMU_CB14_PMAUTHSTATUS_2_APPS_ADDR A:0x61e1efb8
y.create.l HWIO_APPS_SMMU_CB15_PMAUTHSTATUS_2_APPS_ADDR A:0x61e1ffb8
y.create.l HWIO_SMMU_INTR_SEL_SEC_ADDR A:0x61ef0000
y.create.l HWIO_SMMU_MISC_TIE_OFF_SEC_ADDR A:0x61ef0008
y.create.l HWIO_SMMU_CATS_64_BIT_CTL_SEC_ADDR A:0x61ef0010
y.create.l HWIO_SMMU_APP_TCU_PTW_VMID_SEC_ADDR A:0x61ef0018
y.create.l HWIO_SMMU_SPARE_REG_1_SEC_ADDR A:0x61ef0020
y.create.l HWIO_SMMU_INTR_SEL_NSHYP_ADDR A:0x61ef1000
y.create.l HWIO_SMMU_MSA_BYPASS_ERR_ADDR_NSHYP_ADDR A:0x61ef1008
y.create.l HWIO_SMMU_PTW_ARCH_DBG_MON_CTL_NSHYP_ADDR A:0x61ef1010
y.create.l HWIO_SMMU_PTW_ARCH_DBG_MON_MASK_NSHYP_ADDR A:0x61ef1018
y.create.l HWIO_SMMU_PTW_ARCH_DBG_MON_MATCH_NSHYP_ADDR A:0x61ef1020
y.create.l HWIO_SMMU_PTW_RCH_DBG_MON_CTL_NSHYP_ADDR A:0x61ef1028
y.create.l HWIO_SMMU_PTW_RCH_DBG_MON_MASK_NSHYP_ADDR A:0x61ef1030
y.create.l HWIO_SMMU_PTW_RCH_DBG_MON_MATCH_NSHYP_ADDR A:0x61ef1038
y.create.l HWIO_SMMU_MSA_BYPASS_INTR_EN_NSHYP_ADDR A:0x61ef1040
y.create.l HWIO_SMMU_MSA_BYPASS_INTR_STTS_NSHYP_ADDR A:0x61ef1048
y.create.l HWIO_SMMU_MSA_BYPASS_INTR_CLR_NSHYP_ADDR A:0x61ef1050
y.create.l HWIO_SMMU_PTW_ARCH_DBG_MON_CNTR_NSHYP_ADDR A:0x61ef1058
y.create.l HWIO_SMMU_PTW_ARCH_DBG_MON_SNAP_NSHYP_ADDR A:0x61ef1060
y.create.l HWIO_SMMU_PTW_RCH_DBG_MON_CNTR_NSHYP_ADDR A:0x61ef1068
y.create.l HWIO_SMMU_PTW_RCH_DBG_MON_SNAP_NSHYP_ADDR A:0x61ef1070
y.create.l HWIO_SMMU_INTR_SEL_NS_ADDR A:0x61ef2000
y.create.l HWIO_SMMU_TESTBUS_SEL_NS_ADDR A:0x61ef2008
y.create.l HWIO_SMMU_HW_INFO_NS_ADDR A:0x61ef2010
y.create.l HWIO_SMMU_HW_VERSION_NS_ADDR A:0x61ef2018
y.create.l HWIO_SMMU_MODEM_TBU_VA_PA_MATCH_MSA_ADDR A:0x61ef3000
y.create.l HWIO_SMMU_SID2VMID_SMR_MCDMA_0_ADDR A:0x61ef6000
y.create.l HWIO_SMMU_SID2VMID_SMR_MCDMA_1_ADDR A:0x61ef6008
y.create.l HWIO_SMMU_SID2VMID_FAULT_VMID_MCDMA_ADDR A:0x61ef6010
y.create.l HWIO_SMMU_SID2VMID_FAULT_INTR_EN_MCDMA_ADDR A:0x61ef6018
y.create.l HWIO_SMMU_SID2VMID_FAULT_INTR_STTS_MCDMA_ADDR A:0x61ef6020
y.create.l HWIO_SMMU_SID2VMID_FAULT_INTR_CLR_MCDMA_ADDR A:0x61ef6028
y.create.l HWIO_SMMU_PWR_CTRL_MCDMA_REQ_ADDR A:0x61ef6030
y.create.l HWIO_SMMU_PWR_CTRL_MCDMA_ACK_ADDR A:0x61ef6038
y.create.l HWIO_SMMU_SID2VMID_SMR_GPS_0_ADDR A:0x61ef5000
y.create.l HWIO_SMMU_SID2VMID_SMR_GPS_1_ADDR A:0x61ef5008
y.create.l HWIO_SMMU_SID2VMID_FAULT_VMID_GPS_ADDR A:0x61ef5010
y.create.l HWIO_SMMU_SID2VMID_FAULT_INTR_EN_GPS_ADDR A:0x61ef5018
y.create.l HWIO_SMMU_SID2VMID_FAULT_INTR_STTS_GPS_ADDR A:0x61ef5020
y.create.l HWIO_SMMU_SID2VMID_FAULT_INTR_CLR_GPS_ADDR A:0x61ef5028
y.create.l HWIO_SMMU_PWR_CTRL_GPS_REQ_ADDR A:0x61ef5030
y.create.l HWIO_SMMU_PWR_CTRL_GPS_ACK_ADDR A:0x61ef5038
y.create.l HWIO_SMMU_SID2VMID_SMR_PERIPH_0_ADDR A:0x61ef4000
y.create.l HWIO_SMMU_SID2VMID_SMR_PERIPH_1_ADDR A:0x61ef4008
y.create.l HWIO_SMMU_SID2VMID_SMR_PERIPH_2_ADDR A:0x61ef4010
y.create.l HWIO_SMMU_SID2VMID_SMR_PERIPH_3_ADDR A:0x61ef4018
y.create.l HWIO_SMMU_SID2VMID_SMR_PERIPH_4_ADDR A:0x61ef4020
y.create.l HWIO_SMMU_SID2VMID_SMR_PERIPH_5_ADDR A:0x61ef4028
y.create.l HWIO_SMMU_SID2VMID_SMR_PERIPH_6_ADDR A:0x61ef4030
y.create.l HWIO_SMMU_SID2VMID_SMR_PERIPH_7_ADDR A:0x61ef4038
y.create.l HWIO_SMMU_SID2VMID_SMR_PERIPH_8_ADDR A:0x61ef4040
y.create.l HWIO_SMMU_SID2VMID_SMR_PERIPH_9_ADDR A:0x61ef4048
y.create.l HWIO_SMMU_SID2VMID_FAULT_VMID_PERIPH_ADDR A:0x61ef4178
y.create.l HWIO_SMMU_SID2VMID_FAULT_INTR_EN_PERIPH_ADDR A:0x61ef4180
y.create.l HWIO_SMMU_SID2VMID_FAULT_INTR_STTS_PERIPH_ADDR A:0x61ef4188
y.create.l HWIO_SMMU_SID2VMID_FAULT_INTR_CLR_PERIPH_ADDR A:0x61ef4190
y.create.l HWIO_SMMU_PWR_CTRL_PERIPH_REQ_ADDR A:0x61ef4198
y.create.l HWIO_SMMU_PWR_CTRL_PERIPH_ACK_ADDR A:0x61ef41a0
y.create.l HWIO_SMMU_SID2VMID_SMR_QDSP_0_ADDR A:0x61ef7000
y.create.l HWIO_SMMU_SID2VMID_SMR_QDSP_1_ADDR A:0x61ef7008
y.create.l HWIO_SMMU_SID2VMID_FAULT_VMID_QDSP_ADDR A:0x61ef7010
y.create.l HWIO_SMMU_SID2VMID_FAULT_INTR_EN_QDSP_ADDR A:0x61ef7018
y.create.l HWIO_SMMU_SID2VMID_FAULT_INTR_STTS_QDSP_ADDR A:0x61ef7020
y.create.l HWIO_SMMU_SID2VMID_FAULT_INTR_CLR_QDSP_ADDR A:0x61ef7028
y.create.l HWIO_SPDM_CREG_CFG0_ADDR A:0x60040000
y.create.l HWIO_SPDM_CREG_HW_INFO_ADDR A:0x60040004
y.create.l HWIO_SPDM_CREG_HW_VERSION_ADDR A:0x60040008
y.create.l HWIO_SPDM_CREG_MUTEX_0_ADDR A:0x60040100
y.create.l HWIO_SPDM_OLEM_CFG0_ADDR A:0x60041000
y.create.l HWIO_SPDM_OLEM_CFG1_ADDR A:0x60041004
y.create.l HWIO_SPDM_OLEM_CFG2_ADDR A:0x60041008
y.create.l HWIO_SPDM_OLEM_CFG3_ADDR A:0x6004100c
y.create.l HWIO_SPDM_OLEM_CFG4_ADDR A:0x60041010
y.create.l HWIO_SPDM_OLEM_CFG5_ADDR A:0x60041014
y.create.l HWIO_SPDM_OLEM_CFG6_ADDR A:0x60041018
y.create.l HWIO_SPDM_OLEM_CYCLE_C0_OUT_ADDR A:0x60041020
y.create.l HWIO_SPDM_OLEM_CYCLE_C1_OUT_ADDR A:0x60041024
y.create.l HWIO_SPDM_OLEM_CYCLE_C2_OUT_ADDR A:0x60041028
y.create.l HWIO_SPDM_OLEM_CYCLE_C3_OUT_ADDR A:0x6004102c
y.create.l HWIO_SPDM_OLEM_CYCLE_C4_OUT_ADDR A:0x60041030
y.create.l HWIO_SPDM_OLEM_CYCLE_C5_OUT_ADDR A:0x60041034
y.create.l HWIO_SPDM_OLEM_CYCLE_C6_OUT_ADDR A:0x60041038
y.create.l HWIO_SPDM_OLEM_CYCLE_C7_OUT_ADDR A:0x6004103c
y.create.l HWIO_SPDM_OLEM_CYCLE_C8_OUT_ADDR A:0x60041040
y.create.l HWIO_SPDM_OLEM_CYCLE_C9_OUT_ADDR A:0x60041044
y.create.l HWIO_SPDM_OLEM_EVENT_C0_OUT_ADDR A:0x600410a0
y.create.l HWIO_SPDM_OLEM_EVENT_C1_OUT_ADDR A:0x600410a4
y.create.l HWIO_SPDM_OLEM_EVENT_C2_OUT_ADDR A:0x600410a8
y.create.l HWIO_SPDM_OLEM_EVENT_C3_OUT_ADDR A:0x600410ac
y.create.l HWIO_SPDM_OLEM_EVENT_C4_OUT_ADDR A:0x600410b0
y.create.l HWIO_SPDM_OLEM_EVENT_C5_OUT_ADDR A:0x600410b4
y.create.l HWIO_SPDM_OLEM_EVENT_C6_OUT_ADDR A:0x600410b8
y.create.l HWIO_SPDM_OLEM_EVENT_C7_OUT_ADDR A:0x600410bc
y.create.l HWIO_SPDM_OLEM_EVENT_C8_OUT_ADDR A:0x600410c0
y.create.l HWIO_SPDM_OLEM_EVENT_C9_OUT_ADDR A:0x600410c4
y.create.l HWIO_SPDM_OLEM_MULTIBIT_C0_OUT_ADDR A:0x60041120
y.create.l HWIO_SPDM_OLEM_MULTIBIT_C1_OUT_ADDR A:0x60041124
y.create.l HWIO_SPDM_OLEM_MULTIBIT_C2_OUT_ADDR A:0x60041128
y.create.l HWIO_SPDM_OLEM_MULTIBIT_C3_OUT_ADDR A:0x6004112c
y.create.l HWIO_SPDM_OLEM_MULTIBIT_C4_OUT_ADDR A:0x60041130
y.create.l HWIO_SPDM_OLEM_MULTIBIT_C5_OUT_ADDR A:0x60041134
y.create.l HWIO_SPDM_OLEM_MULTIBIT_C6_OUT_ADDR A:0x60041138
y.create.l HWIO_SPDM_OLEM_MULTIBIT_C7_OUT_ADDR A:0x6004113c
y.create.l HWIO_SPDM_RT_LOW_THRESH_STATUS_ADDR A:0x60042000
y.create.l HWIO_SPDM_RT_HIGH_THRESH_STATUS_ADDR A:0x60042004
y.create.l HWIO_SPDM_RT_LOW_IRQ_EN_0_ADDR A:0x60042010
y.create.l HWIO_SPDM_RT_LOW_IRQ_EN_1_ADDR A:0x60042014
y.create.l HWIO_SPDM_RT_LOW_IRQ_EN_2_ADDR A:0x60042018
y.create.l HWIO_SPDM_RT_LOW_IRQ_EN_3_ADDR A:0x6004201c
y.create.l HWIO_SPDM_RT_HIGH_IRQ_EN_0_ADDR A:0x60042020
y.create.l HWIO_SPDM_RT_HIGH_IRQ_EN_1_ADDR A:0x60042024
y.create.l HWIO_SPDM_RT_HIGH_IRQ_EN_2_ADDR A:0x60042028
y.create.l HWIO_SPDM_RT_HIGH_IRQ_EN_3_ADDR A:0x6004202c
y.create.l HWIO_SPDM_RT_IRQ_TIMER_0_ADDR A:0x60042030
y.create.l HWIO_SPDM_RT_IRQ_TIMER_1_ADDR A:0x60042034
y.create.l HWIO_SPDM_RT_IRQ_TIMER_2_ADDR A:0x60042038
y.create.l HWIO_SPDM_RT_IRQ_TIMER_3_ADDR A:0x6004203c
y.create.l HWIO_SPDM_RT_DIAG_MUX_SEL_ADDR A:0x60042040
y.create.l HWIO_SPDM_RT_MON_EN_ADDR A:0x60042050
y.create.l HWIO_SPDM_RT_MON_EN_SET_ADDR A:0x60042054
y.create.l HWIO_SPDM_RT_MON_EN_CLEAR_ADDR A:0x60042058
y.create.l HWIO_SPDM_RT_MON_RST_ADDR A:0x60042060
y.create.l HWIO_SPDM_RT_MON_RST_SET_ADDR A:0x60042064
y.create.l HWIO_SPDM_RT_MON_RST_CLEAR_ADDR A:0x60042068
y.create.l HWIO_SPDM_RT_MON_CFG_0_ADDR A:0x60042100
y.create.l HWIO_SPDM_RT_MON_CFG_1_ADDR A:0x60042110
y.create.l HWIO_SPDM_RT_MON_CFG_2_ADDR A:0x60042120
y.create.l HWIO_SPDM_RT_MON_CFG_3_ADDR A:0x60042130
y.create.l HWIO_SPDM_RT_MON_CFG_4_ADDR A:0x60042140
y.create.l HWIO_SPDM_RT_MON_CFG_5_ADDR A:0x60042150
y.create.l HWIO_SPDM_RT_MON_CFG_6_ADDR A:0x60042160
y.create.l HWIO_SPDM_RT_MON_CFG_7_ADDR A:0x60042170
y.create.l HWIO_SPDM_RT_MON_CFG_8_ADDR A:0x60042180
y.create.l HWIO_SPDM_RT_MON_CFG_9_ADDR A:0x60042190
y.create.l HWIO_SPDM_RT_THRESH_CFG_0_ADDR A:0x60042104
y.create.l HWIO_SPDM_RT_THRESH_CFG_1_ADDR A:0x60042114
y.create.l HWIO_SPDM_RT_THRESH_CFG_2_ADDR A:0x60042124
y.create.l HWIO_SPDM_RT_THRESH_CFG_3_ADDR A:0x60042134
y.create.l HWIO_SPDM_RT_THRESH_CFG_4_ADDR A:0x60042144
y.create.l HWIO_SPDM_RT_THRESH_CFG_5_ADDR A:0x60042154
y.create.l HWIO_SPDM_RT_THRESH_CFG_6_ADDR A:0x60042164
y.create.l HWIO_SPDM_RT_THRESH_CFG_7_ADDR A:0x60042174
y.create.l HWIO_SPDM_RT_THRESH_CFG_8_ADDR A:0x60042184
y.create.l HWIO_SPDM_RT_THRESH_CFG_9_ADDR A:0x60042194
y.create.l HWIO_SPDM_RT_MON_STATUS_0_ADDR A:0x60042108
y.create.l HWIO_SPDM_RT_MON_STATUS_1_ADDR A:0x60042118
y.create.l HWIO_SPDM_RT_MON_STATUS_2_ADDR A:0x60042128
y.create.l HWIO_SPDM_RT_MON_STATUS_3_ADDR A:0x60042138
y.create.l HWIO_SPDM_RT_MON_STATUS_4_ADDR A:0x60042148
y.create.l HWIO_SPDM_RT_MON_STATUS_5_ADDR A:0x60042158
y.create.l HWIO_SPDM_RT_MON_STATUS_6_ADDR A:0x60042168
y.create.l HWIO_SPDM_RT_MON_STATUS_7_ADDR A:0x60042178
y.create.l HWIO_SPDM_RT_MON_STATUS_8_ADDR A:0x60042188
y.create.l HWIO_SPDM_RT_MON_STATUS_9_ADDR A:0x60042198
y.create.l HWIO_SPDM_SREG_CFG0_ADDR A:0x60044000
y.create.l HWIO_SPDM_SREG_CFG1_ADDR A:0x60044004
y.create.l HWIO_SPDM_SREG_MUTEX_0_ADDR A:0x60044100
y.create.l HWIO_TLMM_XPU_SCR_ADDR A:0x61300000
y.create.l HWIO_TLMM_XPU_SWDR_ADDR A:0x61300004
y.create.l HWIO_TLMM_XPU_PRTN_RACR_SSHADOW_ADDR A:0x61300008
y.create.l HWIO_TLMM_XPU_PRTN_WACR_SSHADOW_ADDR A:0x6130000c
y.create.l HWIO_TLMM_XPU_PRTN_START_SSHADOW0_ADDR A:0x61300010
y.create.l HWIO_TLMM_XPU_PRTN_END_SSHADOW0_ADDR A:0x61300018
y.create.l HWIO_TLMM_XPU_SEAR0_ADDR A:0x61300040
y.create.l HWIO_TLMM_XPU_SESR_ADDR A:0x61300048
y.create.l HWIO_TLMM_XPU_SESRRESTORE_ADDR A:0x6130004c
y.create.l HWIO_TLMM_XPU_SESYNR0_ADDR A:0x61300050
y.create.l HWIO_TLMM_XPU_SESYNR1_ADDR A:0x61300054
y.create.l HWIO_TLMM_XPU_SESYNR2_ADDR A:0x61300058
y.create.l HWIO_TLMM_XPU_MCR_ADDR A:0x61300100
y.create.l HWIO_TLMM_XPU_MEAR0_ADDR A:0x61300140
y.create.l HWIO_TLMM_XPU_MESR_ADDR A:0x61300148
y.create.l HWIO_TLMM_XPU_MESRRESTORE_ADDR A:0x6130014c
y.create.l HWIO_TLMM_XPU_MESYNR0_ADDR A:0x61300150
y.create.l HWIO_TLMM_XPU_MESYNR1_ADDR A:0x61300154
y.create.l HWIO_TLMM_XPU_MESYNR2_ADDR A:0x61300158
y.create.l HWIO_TLMM_XPU_CR_ADDR A:0x61300080
y.create.l HWIO_TLMM_XPU_PRTN_RACR_SHADOW_ADDR A:0x61300088
y.create.l HWIO_TLMM_XPU_PRTN_WACR_SHADOW_ADDR A:0x6130008c
y.create.l HWIO_TLMM_XPU_PRTN_START_SHADOW0_ADDR A:0x61300090
y.create.l HWIO_TLMM_XPU_PRTN_END_SHADOW0_ADDR A:0x61300098
y.create.l HWIO_TLMM_XPU_RPU_ACR0_ADDR A:0x613000a0
y.create.l HWIO_TLMM_XPU_EAR0_ADDR A:0x613000c0
y.create.l HWIO_TLMM_XPU_ESR_ADDR A:0x613000c8
y.create.l HWIO_TLMM_XPU_ESRRESTORE_ADDR A:0x613000cc
y.create.l HWIO_TLMM_XPU_ESYNR0_ADDR A:0x613000d0
y.create.l HWIO_TLMM_XPU_ESYNR1_ADDR A:0x613000d4
y.create.l HWIO_TLMM_XPU_ESYNR2_ADDR A:0x613000d8
y.create.l HWIO_TLMM_XPU_UMR_RACR_ADDR A:0x613000e0
y.create.l HWIO_TLMM_XPU_UMR_WACR_ADDR A:0x613000e4
y.create.l HWIO_TLMM_XPU_UMR_CNTL_ADDR A:0x613000f0
y.create.l HWIO_TLMM_XPU_IDR0_ADDR A:0x61300074
y.create.l HWIO_TLMM_XPU_IDR1_ADDR A:0x61300078
y.create.l HWIO_TLMM_XPU_REV_ADDR A:0x6130007c
y.create.l HWIO_TLMM_XPU_PRT0_RACR0_ADDR A:0x61300200
y.create.l HWIO_TLMM_XPU_PRT1_RACR0_ADDR A:0x61300280
y.create.l HWIO_TLMM_XPU_PRT2_RACR0_ADDR A:0x61300300
y.create.l HWIO_TLMM_XPU_PRT3_RACR0_ADDR A:0x61300380
y.create.l HWIO_TLMM_XPU_PRT4_RACR0_ADDR A:0x61300400
y.create.l HWIO_TLMM_XPU_PRT5_RACR0_ADDR A:0x61300480
y.create.l HWIO_TLMM_XPU_PRT6_RACR0_ADDR A:0x61300500
y.create.l HWIO_TLMM_XPU_PRT7_RACR0_ADDR A:0x61300580
y.create.l HWIO_TLMM_XPU_PRT8_RACR0_ADDR A:0x61300600
y.create.l HWIO_TLMM_XPU_PRT9_RACR0_ADDR A:0x61300680
y.create.l HWIO_TLMM_XPU_PRT0_WACR0_ADDR A:0x61300220
y.create.l HWIO_TLMM_XPU_PRT1_WACR0_ADDR A:0x613002a0
y.create.l HWIO_TLMM_XPU_PRT2_WACR0_ADDR A:0x61300320
y.create.l HWIO_TLMM_XPU_PRT3_WACR0_ADDR A:0x613003a0
y.create.l HWIO_TLMM_XPU_PRT4_WACR0_ADDR A:0x61300420
y.create.l HWIO_TLMM_XPU_PRT5_WACR0_ADDR A:0x613004a0
y.create.l HWIO_TLMM_XPU_PRT6_WACR0_ADDR A:0x61300520
y.create.l HWIO_TLMM_XPU_PRT7_WACR0_ADDR A:0x613005a0
y.create.l HWIO_TLMM_XPU_PRT8_WACR0_ADDR A:0x61300620
y.create.l HWIO_TLMM_XPU_PRT9_WACR0_ADDR A:0x613006a0
y.create.l HWIO_TLMM_XPU_PRT0_START0_ADDR A:0x61300240
y.create.l HWIO_TLMM_XPU_PRT1_START0_ADDR A:0x613002c0
y.create.l HWIO_TLMM_XPU_PRT2_START0_ADDR A:0x61300340
y.create.l HWIO_TLMM_XPU_PRT3_START0_ADDR A:0x613003c0
y.create.l HWIO_TLMM_XPU_PRT4_START0_ADDR A:0x61300440
y.create.l HWIO_TLMM_XPU_PRT5_START0_ADDR A:0x613004c0
y.create.l HWIO_TLMM_XPU_PRT6_START0_ADDR A:0x61300540
y.create.l HWIO_TLMM_XPU_PRT7_START0_ADDR A:0x613005c0
y.create.l HWIO_TLMM_XPU_PRT8_START0_ADDR A:0x61300640
y.create.l HWIO_TLMM_XPU_PRT9_START0_ADDR A:0x613006c0
y.create.l HWIO_TLMM_XPU_PRT0_END0_ADDR A:0x61300248
y.create.l HWIO_TLMM_XPU_PRT1_END0_ADDR A:0x613002c8
y.create.l HWIO_TLMM_XPU_PRT2_END0_ADDR A:0x61300348
y.create.l HWIO_TLMM_XPU_PRT3_END0_ADDR A:0x613003c8
y.create.l HWIO_TLMM_XPU_PRT4_END0_ADDR A:0x61300448
y.create.l HWIO_TLMM_XPU_PRT5_END0_ADDR A:0x613004c8
y.create.l HWIO_TLMM_XPU_PRT6_END0_ADDR A:0x61300548
y.create.l HWIO_TLMM_XPU_PRT7_END0_ADDR A:0x613005c8
y.create.l HWIO_TLMM_XPU_PRT8_END0_ADDR A:0x61300648
y.create.l HWIO_TLMM_XPU_PRT9_END0_ADDR A:0x613006c8
y.create.l HWIO_TLMM_XPU_PRT0_SCR_ADDR A:0x61300250
y.create.l HWIO_TLMM_XPU_PRT1_SCR_ADDR A:0x613002d0
y.create.l HWIO_TLMM_XPU_PRT2_SCR_ADDR A:0x61300350
y.create.l HWIO_TLMM_XPU_PRT3_SCR_ADDR A:0x613003d0
y.create.l HWIO_TLMM_XPU_PRT4_SCR_ADDR A:0x61300450
y.create.l HWIO_TLMM_XPU_PRT5_SCR_ADDR A:0x613004d0
y.create.l HWIO_TLMM_XPU_PRT6_SCR_ADDR A:0x61300550
y.create.l HWIO_TLMM_XPU_PRT7_SCR_ADDR A:0x613005d0
y.create.l HWIO_TLMM_XPU_PRT8_SCR_ADDR A:0x61300650
y.create.l HWIO_TLMM_XPU_PRT9_SCR_ADDR A:0x613006d0
y.create.l HWIO_TLMM_XPU_PRT0_MCR_ADDR A:0x61300254
y.create.l HWIO_TLMM_XPU_PRT1_MCR_ADDR A:0x613002d4
y.create.l HWIO_TLMM_XPU_PRT2_MCR_ADDR A:0x61300354
y.create.l HWIO_TLMM_XPU_PRT3_MCR_ADDR A:0x613003d4
y.create.l HWIO_TLMM_XPU_PRT4_MCR_ADDR A:0x61300454
y.create.l HWIO_TLMM_XPU_PRT5_MCR_ADDR A:0x613004d4
y.create.l HWIO_TLMM_XPU_PRT6_MCR_ADDR A:0x61300554
y.create.l HWIO_TLMM_XPU_PRT7_MCR_ADDR A:0x613005d4
y.create.l HWIO_TLMM_XPU_PRT8_MCR_ADDR A:0x61300654
y.create.l HWIO_TLMM_XPU_PRT9_MCR_ADDR A:0x613006d4
y.create.l HWIO_TLMM_XPU_PRT0_CNTL0_ADDR A:0x61300258
y.create.l HWIO_TLMM_XPU_PRT1_CNTL0_ADDR A:0x613002d8
y.create.l HWIO_TLMM_XPU_PRT2_CNTL0_ADDR A:0x61300358
y.create.l HWIO_TLMM_XPU_PRT3_CNTL0_ADDR A:0x613003d8
y.create.l HWIO_TLMM_XPU_PRT4_CNTL0_ADDR A:0x61300458
y.create.l HWIO_TLMM_XPU_PRT5_CNTL0_ADDR A:0x613004d8
y.create.l HWIO_TLMM_XPU_PRT6_CNTL0_ADDR A:0x61300558
y.create.l HWIO_TLMM_XPU_PRT7_CNTL0_ADDR A:0x613005d8
y.create.l HWIO_TLMM_XPU_PRT8_CNTL0_ADDR A:0x61300658
y.create.l HWIO_TLMM_XPU_PRT9_CNTL0_ADDR A:0x613006d8
y.create.l HWIO_TLMM_XPU_PRT0_CNTL1_ADDR A:0x6130025c
y.create.l HWIO_TLMM_XPU_PRT1_CNTL1_ADDR A:0x613002dc
y.create.l HWIO_TLMM_XPU_PRT2_CNTL1_ADDR A:0x6130035c
y.create.l HWIO_TLMM_XPU_PRT3_CNTL1_ADDR A:0x613003dc
y.create.l HWIO_TLMM_XPU_PRT4_CNTL1_ADDR A:0x6130045c
y.create.l HWIO_TLMM_XPU_PRT5_CNTL1_ADDR A:0x613004dc
y.create.l HWIO_TLMM_XPU_PRT6_CNTL1_ADDR A:0x6130055c
y.create.l HWIO_TLMM_XPU_PRT7_CNTL1_ADDR A:0x613005dc
y.create.l HWIO_TLMM_XPU_PRT8_CNTL1_ADDR A:0x6130065c
y.create.l HWIO_TLMM_XPU_PRT9_CNTL1_ADDR A:0x613006dc
y.create.l HWIO_TLMM_GPIO_CFG0_ADDR A:0x61000000
y.create.l HWIO_TLMM_GPIO_CFG1_ADDR A:0x61001000
y.create.l HWIO_TLMM_GPIO_CFG2_ADDR A:0x61002000
y.create.l HWIO_TLMM_GPIO_CFG3_ADDR A:0x61003000
y.create.l HWIO_TLMM_GPIO_CFG4_ADDR A:0x61004000
y.create.l HWIO_TLMM_GPIO_CFG5_ADDR A:0x61005000
y.create.l HWIO_TLMM_GPIO_CFG6_ADDR A:0x61006000
y.create.l HWIO_TLMM_GPIO_CFG7_ADDR A:0x61007000
y.create.l HWIO_TLMM_GPIO_CFG8_ADDR A:0x61008000
y.create.l HWIO_TLMM_GPIO_CFG9_ADDR A:0x61009000
y.create.l HWIO_TLMM_GPIO_IN_OUT0_ADDR A:0x61000004
y.create.l HWIO_TLMM_GPIO_IN_OUT1_ADDR A:0x61001004
y.create.l HWIO_TLMM_GPIO_IN_OUT2_ADDR A:0x61002004
y.create.l HWIO_TLMM_GPIO_IN_OUT3_ADDR A:0x61003004
y.create.l HWIO_TLMM_GPIO_IN_OUT4_ADDR A:0x61004004
y.create.l HWIO_TLMM_GPIO_IN_OUT5_ADDR A:0x61005004
y.create.l HWIO_TLMM_GPIO_IN_OUT6_ADDR A:0x61006004
y.create.l HWIO_TLMM_GPIO_IN_OUT7_ADDR A:0x61007004
y.create.l HWIO_TLMM_GPIO_IN_OUT8_ADDR A:0x61008004
y.create.l HWIO_TLMM_GPIO_IN_OUT9_ADDR A:0x61009004
y.create.l HWIO_TLMM_GPIO_INTR_CFG0_ADDR A:0x61000008
y.create.l HWIO_TLMM_GPIO_INTR_CFG1_ADDR A:0x61001008
y.create.l HWIO_TLMM_GPIO_INTR_CFG2_ADDR A:0x61002008
y.create.l HWIO_TLMM_GPIO_INTR_CFG3_ADDR A:0x61003008
y.create.l HWIO_TLMM_GPIO_INTR_CFG4_ADDR A:0x61004008
y.create.l HWIO_TLMM_GPIO_INTR_CFG5_ADDR A:0x61005008
y.create.l HWIO_TLMM_GPIO_INTR_CFG6_ADDR A:0x61006008
y.create.l HWIO_TLMM_GPIO_INTR_CFG7_ADDR A:0x61007008
y.create.l HWIO_TLMM_GPIO_INTR_CFG8_ADDR A:0x61008008
y.create.l HWIO_TLMM_GPIO_INTR_CFG9_ADDR A:0x61009008
y.create.l HWIO_TLMM_GPIO_INTR_STATUS0_ADDR A:0x6100000c
y.create.l HWIO_TLMM_GPIO_INTR_STATUS1_ADDR A:0x6100100c
y.create.l HWIO_TLMM_GPIO_INTR_STATUS2_ADDR A:0x6100200c
y.create.l HWIO_TLMM_GPIO_INTR_STATUS3_ADDR A:0x6100300c
y.create.l HWIO_TLMM_GPIO_INTR_STATUS4_ADDR A:0x6100400c
y.create.l HWIO_TLMM_GPIO_INTR_STATUS5_ADDR A:0x6100500c
y.create.l HWIO_TLMM_GPIO_INTR_STATUS6_ADDR A:0x6100600c
y.create.l HWIO_TLMM_GPIO_INTR_STATUS7_ADDR A:0x6100700c
y.create.l HWIO_TLMM_GPIO_INTR_STATUS8_ADDR A:0x6100800c
y.create.l HWIO_TLMM_GPIO_INTR_STATUS9_ADDR A:0x6100900c
y.create.l HWIO_TLMM_CLK_GATE_EN_ADDR A:0x61100000
y.create.l HWIO_TLMM_IE_CTRL_DISABLE_ADDR A:0x61100004
y.create.l HWIO_TLMM_MPM_WAKEUP_INT_EN_0_ADDR A:0x61100008
y.create.l HWIO_TLMM_MPM_WAKEUP_INT_EN_1_ADDR A:0x6110000c
y.create.l HWIO_TLMM_INT_JTAG_CTL_ADDR A:0x61110000
y.create.l HWIO_TLMM_ETM_MODE_ADDR A:0x61110004
y.create.l HWIO_TLMM_DBG_BUS_OUT_SEL_ADDR A:0x61110008
y.create.l HWIO_TLMM_CHIP_MODE_ADDR A:0x6111000c
y.create.l HWIO_TLMM_SPARE_ADDR A:0x6110e000
y.create.l HWIO_SPARE1_ADDR A:0x6111001c
y.create.l HWIO_SPARE2_ADDR A:0x61110020
y.create.l HWIO_TLMM_HW_REVISION_NUMBER_ADDR A:0x61110010
y.create.l HWIO_TLMM_PERIPH_CHAR_TEST_MODE_ADDR A:0x61110014
y.create.l HWIO_TLMM_EBI2_EMMC_GPIO_CFG_ADDR A:0x61111000
y.create.l HWIO_TLMM_HSIC_CAL_PAD_CTL_ADDR A:0x61112000
y.create.l HWIO_TLMM_HSIC_DATA_PAD_CTL_ADDR A:0x61112004
y.create.l HWIO_TLMM_HSIC_STROBE_PAD_CTL_ADDR A:0x61112008
y.create.l HWIO_TLMM_GMAC_MDIO_CTL_ADDR A:0x6111200c
y.create.l HWIO_TLMM_PBL_DEBUG_ADDR A:0x61110018
y.create.l HWIO_TLMM_RFFE_CTL_ADDR A:0x61108000
y.create.l HWIO_TLMM_RESOUT_HDRV_CTL_ADDR A:0x6110d000
y.create.l HWIO_TLMM_JTAG_HDRV_CTL_ADDR A:0x6110c000
y.create.l HWIO_TLMM_PMIC_HDRV_PULL_CTL_ADDR A:0x6110b000
y.create.l HWIO_TLMM_SDC1_HDRV_PULL_CTL_ADDR A:0x6110a000
y.create.l HWIO_TLMM_SDC2_HDRV_PULL_CTL_ADDR A:0x61109000
y.create.l HWIO_TLMM_MODE_PULL_CTL_ADDR A:0x61107000
y.create.l HWIO_TLMM_QDSD_HDRV_PULL_DEBUG_GPIO_CTL_ADDR A:0x6119c000
y.create.l HWIO_TLMM_QDSD_BOOT_CTL_ADDR A:0x6119d000
y.create.l HWIO_TLMM_QDSD_CONFIG_CTL_ADDR A:0x6119e000
y.create.l HWIO_TLMM_QDSD_STATUS_CTL_ADDR A:0x6119f000
y.create.l HWIO_TLMM_QDSD_HYS_CTL_ADDR A:0x611a7000
y.create.l HWIO_TLMM_QDSD_DEBUG_HDRV_PULL_CTL_ADDR A:0x611a0000
y.create.l HWIO_TLMM_QDSD_GPIO_CTL_ADDR A:0x611a1000
y.create.l HWIO_TLMM_QDSD_INTR_ENABLE_CTL_ADDR A:0x611a2000
y.create.l HWIO_TLMM_QDSD_INTR_CLEAR_CTL_ADDR A:0x611a3000
y.create.l HWIO_TLMM_QDSD_SPARE1_CTL_ADDR A:0x611a5000
y.create.l HWIO_TLMM_QDSD_SPARE2_CTL_ADDR A:0x611a6000
y.create.l HWIO_TLMM_QDSD_TIMEOUT_VALUE_CTL_ADDR A:0x611a4000
y.create.l HWIO_TLMM_GPIO_HS_I2C_CTL_ADDR A:0x6110f000
y.create.l HWIO_TLMM_DIR_CONN_INTR0_CFG_WCSS_ADDR A:0x61106000
y.create.l HWIO_TLMM_DIR_CONN_INTR1_CFG_WCSS_ADDR A:0x61106004
y.create.l HWIO_TLMM_DIR_CONN_INTR0_CFG_SENSORS_ADDR A:0x61105000
y.create.l HWIO_TLMM_DIR_CONN_INTR1_CFG_SENSORS_ADDR A:0x61105004
y.create.l HWIO_TLMM_DIR_CONN_INTR2_CFG_SENSORS_ADDR A:0x61105008
y.create.l HWIO_TLMM_DIR_CONN_INTR3_CFG_SENSORS_ADDR A:0x6110500c
y.create.l HWIO_TLMM_DIR_CONN_INTR4_CFG_SENSORS_ADDR A:0x61105010
y.create.l HWIO_TLMM_DIR_CONN_INTR5_CFG_SENSORS_ADDR A:0x61105014
y.create.l HWIO_TLMM_DIR_CONN_INTR6_CFG_SENSORS_ADDR A:0x61105018
y.create.l HWIO_TLMM_DIR_CONN_INTR7_CFG_SENSORS_ADDR A:0x6110501c
y.create.l HWIO_TLMM_DIR_CONN_INTR8_CFG_SENSORS_ADDR A:0x61105020
y.create.l HWIO_TLMM_DIR_CONN_INTR9_CFG_SENSORS_ADDR A:0x61105024
y.create.l HWIO_TLMM_DIR_CONN_INTR0_CFG_LPA_DSP_ADDR A:0x61104000
y.create.l HWIO_TLMM_DIR_CONN_INTR1_CFG_LPA_DSP_ADDR A:0x61104004
y.create.l HWIO_TLMM_DIR_CONN_INTR2_CFG_LPA_DSP_ADDR A:0x61104008
y.create.l HWIO_TLMM_DIR_CONN_INTR3_CFG_LPA_DSP_ADDR A:0x6110400c
y.create.l HWIO_TLMM_DIR_CONN_INTR4_CFG_LPA_DSP_ADDR A:0x61104010
y.create.l HWIO_TLMM_DIR_CONN_INTR5_CFG_LPA_DSP_ADDR A:0x61104014
y.create.l HWIO_TLMM_DIR_CONN_INTR0_CFG_RPM_ADDR A:0x61103000
y.create.l HWIO_TLMM_DIR_CONN_INTR0_CFG_APSS_ADDR A:0x61102000
y.create.l HWIO_TLMM_DIR_CONN_INTR1_CFG_APSS_ADDR A:0x61102004
y.create.l HWIO_TLMM_DIR_CONN_INTR2_CFG_APSS_ADDR A:0x61102008
y.create.l HWIO_TLMM_DIR_CONN_INTR3_CFG_APSS_ADDR A:0x6110200c
y.create.l HWIO_TLMM_DIR_CONN_INTR4_CFG_APSS_ADDR A:0x61102010
y.create.l HWIO_TLMM_DIR_CONN_INTR5_CFG_APSS_ADDR A:0x61102014
y.create.l HWIO_TLMM_DIR_CONN_INTR6_CFG_APSS_ADDR A:0x61102018
y.create.l HWIO_TLMM_DIR_CONN_INTR7_CFG_APSS_ADDR A:0x6110201c
y.create.l HWIO_TLMM_DIR_CONN_INTR0_CFG_MSS_ADDR A:0x61101000
y.create.l HWIO_TLMM_DIR_CONN_INTR1_CFG_MSS_ADDR A:0x61101004
y.create.l HWIO_TLMM_GPIO_OUT_0_ADDR A:0x61200000
y.create.l HWIO_TLMM_GPIO_OUT_1_ADDR A:0x61200004
y.create.l HWIO_TLMM_GPIO_OUT_2_ADDR A:0x61200008
y.create.l HWIO_TLMM_GPIO_OUT_CLR_0_ADDR A:0x61200020
y.create.l HWIO_TLMM_GPIO_OUT_CLR_1_ADDR A:0x61200024
y.create.l HWIO_TLMM_GPIO_OUT_CLR_2_ADDR A:0x61200028
y.create.l HWIO_TLMM_GPIO_OUT_SET_0_ADDR A:0x61200040
y.create.l HWIO_TLMM_GPIO_OUT_SET_1_ADDR A:0x61200044
y.create.l HWIO_TLMM_GPIO_OUT_SET_2_ADDR A:0x61200048
y.create.l HWIO_TLMM_GPIO_IN_0_ADDR A:0x61200060
y.create.l HWIO_TLMM_GPIO_IN_1_ADDR A:0x61200064
y.create.l HWIO_TLMM_GPIO_IN_2_ADDR A:0x61200068
y.create.l HWIO_TLMM_GPIO_OE_0_ADDR A:0x61200080
y.create.l HWIO_TLMM_GPIO_OE_1_ADDR A:0x61200084
y.create.l HWIO_TLMM_GPIO_OE_2_ADDR A:0x61200088
y.create.l HWIO_TLMM_GPIO_OE_CLR_0_ADDR A:0x612000a0
y.create.l HWIO_TLMM_GPIO_OE_CLR_1_ADDR A:0x612000a4
y.create.l HWIO_TLMM_GPIO_OE_CLR_2_ADDR A:0x612000a8
y.create.l HWIO_TLMM_GPIO_OE_SET_0_ADDR A:0x612000c0
y.create.l HWIO_TLMM_GPIO_OE_SET_1_ADDR A:0x612000c4
y.create.l HWIO_TLMM_GPIO_OE_SET_2_ADDR A:0x612000c8
y.create.l HWIO_ULTAUDIO_HW_VERSION_ADDR A:0x67700000
y.create.l HWIO_ULTAUDIO_TCSR_DEBUG_CTL_ADDR A:0x67700004
y.create.l HWIO_LPASS_CSR_GP_CTL_ADDR A:0x67700100
y.create.l HWIO_LPASS_CSR_MEMTYPE_CTL_ADDR A:0x67700104
y.create.l HWIO_LPASS_CSR_DEBUG_BUS_ADDR A:0x67700114
y.create.l HWIO_LPASS_AHBI_CFG_ADDR A:0x67700124
y.create.l HWIO_LPASS_AHBI_LOCK_CTL_ADDR A:0x67700128
y.create.l HWIO_LPASS_AHBI_CFG_EXT_ADDR A:0x6770012c
y.create.l HWIO_LPASS_AHBX_CFG_ADDR A:0x67700140
y.create.l HWIO_LPASS_AHBX_LOCK_CTL_ADDR A:0x67700144
y.create.l HWIO_LPASS_AHBIX_SSR_CTL_ADDR A:0x67700148
y.create.l HWIO_LPASS_AHBIX_STATUS_ADDR A:0x67700150
y.create.l HWIO_LPASS_AHBIX_ACK_ADDR A:0x67700154
y.create.l HWIO_LPASS_AHBIX_EN_ADDR A:0x67700158
y.create.l HWIO_LPASS_AUDIO_CORE_LPM_CGCR_ADDR A:0x6770015c
y.create.l HWIO_LPASS_AUDIO_CORE_AUDSYNC_CGCR_ADDR A:0x67700160
y.create.l HWIO_LPASS_AUDIO_CORE_AVSYNC_CGCR_ADDR A:0x67700164
y.create.l HWIO_LPASS_AUDIO_CORE_AHB2AHB_CODEC_CGCR_ADDR A:0x6770016c
y.create.l HWIO_LPASS_AUDIO_CORE_LPAIF_CTL_CGCR_ADDR A:0x67700170
y.create.l HWIO_LPASS_AUDIO_CORE_VFR_CGCR_ADDR A:0x67700174
y.create.l HWIO_LPASS_AUDIO_CORE_AHB2AHB_PCNOC_SLV_CGCR_ADDR A:0x67700178
y.create.l HWIO_LPASS_AUDIO_CORE_AHB2AHB_PCNOC_MST_CGCR_ADDR A:0x6770017c
y.create.l HWIO_LPASS_AUDIO_CORE_AVTIMER_XO_FM_CGCR_ADDR A:0x67700180
y.create.l HWIO_LPASS_AUDIO_CORE_AVTIMER_XO_BT_CGCR_ADDR A:0x67700184
y.create.l HWIO_LPASS_AUDIO_CORE_SLIMBUS_SLV_CGCR_ADDR A:0x67700188
y.create.l HWIO_LPASS_AUDIO_CORE_SLIMBUS_MST_CGCR_ADDR A:0x6770018c
y.create.l HWIO_LPASS_LPASS_CSR_ADDR_VALID_STATUS_ADDR A:0x67700190
y.create.l HWIO_LPASS_LPASS_CSR_ADDR_VALID_ACK_ADDR A:0x67700194
y.create.l HWIO_LPASS_LPASS_CSR_ADDR_VALID_EN_ADDR A:0x67700198
y.create.l HWIO_LPASS_LPM_CTL_ADDR A:0x6770019c
y.create.l HWIO_LPASS_LPAIF_CTL_ADDR A:0x677001b0
y.create.l HWIO_LPASS_VFR_IRQ_MUX_CTL_ADDR A:0x67701000
y.create.l HWIO_LPASS_VFR_STC_MSB_ADDR A:0x67701004
y.create.l HWIO_LPASS_VFR_STC_LSB_ADDR A:0x67701008
y.create.l HWIO_LPASS_VFR_IRQ_MUX_CTL_1_ADDR A:0x67701010
y.create.l HWIO_LPASS_VFR_STC_MSB_1_ADDR A:0x67701014
y.create.l HWIO_LPASS_VFR_STC_LSB_1_ADDR A:0x67701018
y.create.l HWIO_LPASS_GP_IRQ_TS_MUX_CTL_0_ADDR A:0x67701020
y.create.l HWIO_LPASS_GP_IRQ_STC_MSB_0_ADDR A:0x67701024
y.create.l HWIO_LPASS_GP_IRQ_STC_LSB_0_ADDR A:0x67701028
y.create.l HWIO_LPASS_GP_IRQ_TS_MUX_CTL_1_ADDR A:0x67701030
y.create.l HWIO_LPASS_GP_IRQ_STC_MSB_1_ADDR A:0x67701034
y.create.l HWIO_LPASS_GP_IRQ_STC_LSB_1_ADDR A:0x67701038
y.create.l HWIO_LPASS_LPAIF_VFR_IRQ_CTL_ADDR A:0x67701040
y.create.l HWIO_LPASS_WCN_VFR_IRQ_CTL_ADDR A:0x67701044
y.create.l HWIO_LPASS_AVT_VFR_IRQ_CTL_ADDR A:0x67701048
y.create.l HWIO_LPASS_SLIMBUS_VFR_IRQ_CTL_ADDR A:0x6770104c
y.create.l HWIO_LPASS_CSR_GP_IO_MUX_MIC_CTL_ADDR A:0x67702000
y.create.l HWIO_LPASS_CSR_GP_IO_MUX_SPKR_CTL_ADDR A:0x67702004
y.create.l HWIO_LPASS_CSR_GP_LPAIF_PRI_PCM_PRI_MODE_MUXSEL_ADDR A:0x67702008
y.create.l HWIO_LPASS_CSR_GP_LPAIF_SEC_PCM_SEC_MODE_MUXSEL_ADDR A:0x6770200c
y.create.l HWIO_LPASS_CSR_GP_LPAIF_TER_PCM_TER_MODE_MUXSEL_ADDR A:0x67702010
y.create.l HWIO_LPASS_CSR_GP_IO_MUX_TER_CTL_ADDR A:0x67702014
y.create.l HWIO_LPASS_AHBI_ABT_HW_VERSION_ADDR A:0x67705000
y.create.l HWIO_LPASS_AHBI_ABT_INST_ID_ADDR A:0x67705004
y.create.l HWIO_LPASS_AHBI_ABT_NUM_SLAVES_ADDR A:0x67705008
y.create.l HWIO_LPASS_AHBI_ABT_TIMER_LOADVAL_ADDR A:0x6770500c
y.create.l HWIO_LPASS_AHBI_ABT_TIMER_MODE_ADDR A:0x67705010
y.create.l HWIO_LPASS_AHBI_ABT_INTR_STATUS_ADDR A:0x67705014
y.create.l HWIO_LPASS_AHBI_ABT_INTR_CLEAR_ADDR A:0x67705018
y.create.l HWIO_LPASS_AHBI_ABT_INTR_ENABLE_ADDR A:0x6770501c
y.create.l HWIO_LPASS_AHBI_ABT_SYND_VALID_ADDR A:0x67705020
y.create.l HWIO_LPASS_AHBI_ABT_SYND_CLEAR_ADDR A:0x67705024
y.create.l HWIO_LPASS_AHBI_ABT_SYND_ID_ADDR A:0x67705028
y.create.l HWIO_LPASS_AHBI_ABT_SYND_ADDR0_ADDR A:0x6770502c
y.create.l HWIO_LPASS_AHBI_ABT_SYND_ADDR1_ADDR A:0x67705030
y.create.l HWIO_LPASS_AHBI_ABT_SYND_HREADY_ADDR A:0x67705034
y.create.l HWIO_LPASS_AVTIMER_HW_VERSION_ADDR A:0x67706000
y.create.l HWIO_LPASS_AVTIMER_CTL_ADDR A:0x67706004
y.create.l HWIO_LPASS_AVTIMER_RESMOD_ADDR A:0x67706008
y.create.l HWIO_LPASS_AVTIMER_TIMER_LSB_ADDR A:0x6770600c
y.create.l HWIO_LPASS_AVTIMER_TIMER_MSB_ADDR A:0x67706010
y.create.l HWIO_LPASS_AVTIMER_INT0_LSB_ADDR A:0x67706014
y.create.l HWIO_LPASS_AVTIMER_INT0_MSB_ADDR A:0x67706018
y.create.l HWIO_LPASS_AVTIMER_INT1_LSB_ADDR A:0x6770601c
y.create.l HWIO_LPASS_AVTIMER_INT1_MSB_ADDR A:0x67706020
y.create.l HWIO_LPASS_AVTIMER_TIMEOUT_VAL_ADDR A:0x67706024
y.create.l HWIO_LPASS_AVTIMER_L0_VAL_NEXT_ADDR A:0x67706028
y.create.l HWIO_LPASS_AVTIMER_M0_VAL_NEXT_ADDR A:0x6770602c
y.create.l HWIO_LPASS_AVTIMER_N0_VAL_NEXT_ADDR A:0x67706030
y.create.l HWIO_LPASS_AVTIMER_L0_VAL_CURR_ADDR A:0x67706034
y.create.l HWIO_LPASS_AVTIMER_M0_VAL_CURR_ADDR A:0x67706038
y.create.l HWIO_LPASS_AVTIMER_N0_VAL_CURR_ADDR A:0x6770603c
y.create.l HWIO_LPASS_AVTIMER_MODE_CTL_ADDR A:0x67706040
y.create.l HWIO_LPASS_AVTIMER_LMN_DWT_ADDR A:0x67706044
y.create.l HWIO_LPASS_AVTIMER_LTIME_LSB_ADDR A:0x67706048
y.create.l HWIO_LPASS_AVTIMER_LTIME_MSB_ADDR A:0x6770604c
y.create.l HWIO_LPASS_AVTIMER_EXT_STC_LSB_ADDR A:0x67706050
y.create.l HWIO_LPASS_AVTIMER_EXT_STC_MSB_ADDR A:0x67706054
y.create.l HWIO_LPASS_AVTIMER_RTIME_LSB_ADDR A:0x67706058
y.create.l HWIO_LPASS_AVTIMER_RTIME_MSB_ADDR A:0x6770605c
y.create.l HWIO_LPASS_AVTIMER_RTIME_CTL_ADDR A:0x67706060
y.create.l HWIO_LPASS_AVTIMER_TIME_CTL_ADDR A:0x67706064
y.create.l HWIO_LPASS_AVTIMER_TIMER_LOAD_LSB_NEXT_ADDR A:0x67706068
y.create.l HWIO_LPASS_AVTIMER_TIMER_LOAD_MSB_NEXT_ADDR A:0x6770606c
y.create.l HWIO_LPASS_AVTIMER_TIMER_LOAD_LSB_CURR_ADDR A:0x67706070
y.create.l HWIO_LPASS_AVTIMER_TIMER_LOAD_MSB_CURR_ADDR A:0x67706074
y.create.l HWIO_LPASS_AVTIMER_TIMER_LOAD_DWT_ADDR A:0x67706078
y.create.l HWIO_LPASS_AVTIMER_INT1_ST_ADDR A:0x6770607c
y.create.l HWIO_LPASS_AVTIMER_INT0_ST_ADDR A:0x67706080
y.create.l HWIO_LPASS_AVTIMER_INT1_CTL_ADDR A:0x67706084
y.create.l HWIO_LPASS_AVTIMER_INT0_CTL_ADDR A:0x67706088
y.create.l HWIO_LPASS_AVTIMER_INT_ON_ADDR A:0x6770608c
y.create.l HWIO_LPASS_AVTIMER_TICK_DIV_ADDR A:0x67706090
y.create.l HWIO_LPASS_LPAIF_VERSION_ADDR A:0x67708000
y.create.l HWIO_LPASS_LPAIF_HW_CONFIG_ADDR A:0x67708004
y.create.l HWIO_LPASS_LPAIF_HW_CONFIG2_ADDR A:0x67708008
y.create.l HWIO_LPASS_LPAIF_DMIC_CTL_ADDR A:0x67708080
y.create.l HWIO_LPASS_LPAIF_DMIC_VOL_CTL0_ADDR A:0x67708084
y.create.l HWIO_LPASS_LPAIF_DMIC_VOL_CTL1_ADDR A:0x67708088
y.create.l HWIO_LPASS_LPAIF_WRDMA_LPBK_MIX_ADDR A:0x67708100
y.create.l HWIO_LPASS_LPAIF_MIXER_CTL_ADDR A:0x67708180
y.create.l HWIO_LPASS_LPAIF_EXT_VFR_ADDR A:0x67708200
y.create.l HWIO_LPASS_LPAIF_DEBUG_CTL_ADDR A:0x67708280
y.create.l HWIO_LPASS_LPAIF_PRI_RATE_DET_CONFIG_ADDR A:0x67708300
y.create.l HWIO_LPASS_LPAIF_PRI_RATE_DET_TARGET1_CONFIG_ADDR A:0x67708304
y.create.l HWIO_LPASS_LPAIF_PRI_RATE_DET_TARGET2_CONFIG_ADDR A:0x67708308
y.create.l HWIO_LPASS_LPAIF_PRI_RATE_BIN_ADDR A:0x6770830c
y.create.l HWIO_LPASS_LPAIF_PRI_STC_DIFF_ADDR A:0x67708310
y.create.l HWIO_LPASS_LPAIF_SEC_RATE_DET_CONFIG_ADDR A:0x67708380
y.create.l HWIO_LPASS_LPAIF_SEC_RATE_DET_TARGET1_CONFIG_ADDR A:0x67708384
y.create.l HWIO_LPASS_LPAIF_SEC_RATE_DET_TARGET2_CONFIG_ADDR A:0x67708388
y.create.l HWIO_LPASS_LPAIF_SEC_RATE_BIN_ADDR A:0x6770838c
y.create.l HWIO_LPASS_LPAIF_SEC_STC_DIFF_ADDR A:0x67708390
y.create.l HWIO_LPASS_LPAIF_SPARE_ADDR A:0x67708400
y.create.l HWIO_LPASS_LPAIF_I2S_CTL0_ADDR A:0x67709000
y.create.l HWIO_LPASS_LPAIF_I2S_CTL1_ADDR A:0x6770a000
y.create.l HWIO_LPASS_LPAIF_I2S_CTL2_ADDR A:0x6770b000
y.create.l HWIO_LPASS_LPAIF_PCM_CTL0_ADDR A:0x67709040
y.create.l HWIO_LPASS_LPAIF_PCM_CTL1_ADDR A:0x6770a040
y.create.l HWIO_LPASS_LPAIF_PCM_CTL2_ADDR A:0x6770b040
y.create.l HWIO_LPASS_LPAIF_PCM_SLOT_CTL0_ADDR A:0x67709044
y.create.l HWIO_LPASS_LPAIF_PCM_SLOT_CTL1_ADDR A:0x6770a044
y.create.l HWIO_LPASS_LPAIF_PCM_SLOT_CTL2_ADDR A:0x6770b044
y.create.l HWIO_LPASS_LPAIF_PCM_SLOT_CTL2_0_ADDR A:0x67709048
y.create.l HWIO_LPASS_LPAIF_PCM_SLOT_CTL2_1_ADDR A:0x6770a048
y.create.l HWIO_LPASS_LPAIF_PCM_SLOT_CTL2_2_ADDR A:0x6770b048
y.create.l HWIO_LPASS_LPAIF_PCM_SLOT_CTL3_0_ADDR A:0x6770904c
y.create.l HWIO_LPASS_LPAIF_PCM_SLOT_CTL3_1_ADDR A:0x6770a04c
y.create.l HWIO_LPASS_LPAIF_PCM_SLOT_CTL3_2_ADDR A:0x6770b04c
y.create.l HWIO_LPASS_LPAIF_PCM_TDM_CTL_0_ADDR A:0x67709050
y.create.l HWIO_LPASS_LPAIF_PCM_TDM_CTL_1_ADDR A:0x6770a050
y.create.l HWIO_LPASS_LPAIF_PCM_TDM_CTL_2_ADDR A:0x6770b050
y.create.l HWIO_LPASS_LPAIF_PCM_TDM_SAMPLE_WIDTH_0_ADDR A:0x67709054
y.create.l HWIO_LPASS_LPAIF_PCM_TDM_SAMPLE_WIDTH_1_ADDR A:0x6770a054
y.create.l HWIO_LPASS_LPAIF_PCM_TDM_SAMPLE_WIDTH_2_ADDR A:0x6770b054
y.create.l HWIO_LPASS_LPAIF_IRQ_EN0_ADDR A:0x6770e000
y.create.l HWIO_LPASS_LPAIF_IRQ_EN1_ADDR A:0x6770f000
y.create.l HWIO_LPASS_LPAIF_IRQ_EN2_ADDR A:0x67710000
y.create.l HWIO_LPASS_LPAIF_IRQ_STAT0_ADDR A:0x6770e004
y.create.l HWIO_LPASS_LPAIF_IRQ_STAT1_ADDR A:0x6770f004
y.create.l HWIO_LPASS_LPAIF_IRQ_STAT2_ADDR A:0x67710004
y.create.l HWIO_LPASS_LPAIF_IRQ_RAW_STAT0_ADDR A:0x6770e008
y.create.l HWIO_LPASS_LPAIF_IRQ_RAW_STAT1_ADDR A:0x6770f008
y.create.l HWIO_LPASS_LPAIF_IRQ_RAW_STAT2_ADDR A:0x67710008
y.create.l HWIO_LPASS_LPAIF_IRQ_CLEAR0_ADDR A:0x6770e00c
y.create.l HWIO_LPASS_LPAIF_IRQ_CLEAR1_ADDR A:0x6770f00c
y.create.l HWIO_LPASS_LPAIF_IRQ_CLEAR2_ADDR A:0x6771000c
y.create.l HWIO_LPASS_LPAIF_IRQ_FORCE0_ADDR A:0x6770e010
y.create.l HWIO_LPASS_LPAIF_IRQ_FORCE1_ADDR A:0x6770f010
y.create.l HWIO_LPASS_LPAIF_IRQ_FORCE2_ADDR A:0x67710010
y.create.l HWIO_LPASS_LPAIF_IRQ2_EN0_ADDR A:0x6770e040
y.create.l HWIO_LPASS_LPAIF_IRQ2_EN1_ADDR A:0x6770f040
y.create.l HWIO_LPASS_LPAIF_IRQ2_EN2_ADDR A:0x67710040
y.create.l HWIO_LPASS_LPAIF_IRQ2_STAT0_ADDR A:0x6770e044
y.create.l HWIO_LPASS_LPAIF_IRQ2_STAT1_ADDR A:0x6770f044
y.create.l HWIO_LPASS_LPAIF_IRQ2_STAT2_ADDR A:0x67710044
y.create.l HWIO_LPASS_LPAIF_IRQ2_RAW_STAT0_ADDR A:0x6770e048
y.create.l HWIO_LPASS_LPAIF_IRQ2_RAW_STAT1_ADDR A:0x6770f048
y.create.l HWIO_LPASS_LPAIF_IRQ2_RAW_STAT2_ADDR A:0x67710048
y.create.l HWIO_LPASS_LPAIF_IRQ2_CLEAR0_ADDR A:0x6770e04c
y.create.l HWIO_LPASS_LPAIF_IRQ2_CLEAR1_ADDR A:0x6770f04c
y.create.l HWIO_LPASS_LPAIF_IRQ2_CLEAR2_ADDR A:0x6771004c
y.create.l HWIO_LPASS_LPAIF_IRQ2_FORCE0_ADDR A:0x6770e050
y.create.l HWIO_LPASS_LPAIF_IRQ2_FORCE1_ADDR A:0x6770f050
y.create.l HWIO_LPASS_LPAIF_IRQ2_FORCE2_ADDR A:0x67710050
y.create.l HWIO_LPASS_LPAIF_RDDMA_CTL0_ADDR A:0x67710400
y.create.l HWIO_LPASS_LPAIF_RDDMA_CTL1_ADDR A:0x67711400
y.create.l HWIO_LPASS_LPAIF_RDDMA_CTL2_ADDR A:0x67712400
y.create.l HWIO_LPASS_LPAIF_RDDMA_BASE0_ADDR A:0x67710404
y.create.l HWIO_LPASS_LPAIF_RDDMA_BASE1_ADDR A:0x67711404
y.create.l HWIO_LPASS_LPAIF_RDDMA_BASE2_ADDR A:0x67712404
y.create.l HWIO_LPASS_LPAIF_RDDMA_BUFF_LEN0_ADDR A:0x67710408
y.create.l HWIO_LPASS_LPAIF_RDDMA_BUFF_LEN1_ADDR A:0x67711408
y.create.l HWIO_LPASS_LPAIF_RDDMA_BUFF_LEN2_ADDR A:0x67712408
y.create.l HWIO_LPASS_LPAIF_RDDMA_CURR_ADDR0_ADDR A:0x6771040c
y.create.l HWIO_LPASS_LPAIF_RDDMA_CURR_ADDR1_ADDR A:0x6771140c
y.create.l HWIO_LPASS_LPAIF_RDDMA_CURR_ADDR2_ADDR A:0x6771240c
y.create.l HWIO_LPASS_LPAIF_RDDMA_PER_LEN0_ADDR A:0x67710410
y.create.l HWIO_LPASS_LPAIF_RDDMA_PER_LEN1_ADDR A:0x67711410
y.create.l HWIO_LPASS_LPAIF_RDDMA_PER_LEN2_ADDR A:0x67712410
y.create.l HWIO_LPASS_LPAIF_RDDMA_PER_CNT0_ADDR A:0x67710414
y.create.l HWIO_LPASS_LPAIF_RDDMA_PER_CNT1_ADDR A:0x67711414
y.create.l HWIO_LPASS_LPAIF_RDDMA_PER_CNT2_ADDR A:0x67712414
y.create.l HWIO_LPASS_LPAIF_RDDMA_FRM0_ADDR A:0x67710418
y.create.l HWIO_LPASS_LPAIF_RDDMA_FRM1_ADDR A:0x67711418
y.create.l HWIO_LPASS_LPAIF_RDDMA_FRM2_ADDR A:0x67712418
y.create.l HWIO_LPASS_LPAIF_RDDMA_FRMCLR0_ADDR A:0x6771041c
y.create.l HWIO_LPASS_LPAIF_RDDMA_FRMCLR1_ADDR A:0x6771141c
y.create.l HWIO_LPASS_LPAIF_RDDMA_FRMCLR2_ADDR A:0x6771241c
y.create.l HWIO_LPASS_LPAIF_RDDMA_SET_BUFF_CNT0_ADDR A:0x67710420
y.create.l HWIO_LPASS_LPAIF_RDDMA_SET_BUFF_CNT1_ADDR A:0x67711420
y.create.l HWIO_LPASS_LPAIF_RDDMA_SET_BUFF_CNT2_ADDR A:0x67712420
y.create.l HWIO_LPASS_LPAIF_RDDMA_SET_PER_CNT0_ADDR A:0x67710424
y.create.l HWIO_LPASS_LPAIF_RDDMA_SET_PER_CNT1_ADDR A:0x67711424
y.create.l HWIO_LPASS_LPAIF_RDDMA_SET_PER_CNT2_ADDR A:0x67712424
y.create.l HWIO_LPASS_LPAIF_RDDMA_STC_LSB0_ADDR A:0x67710428
y.create.l HWIO_LPASS_LPAIF_RDDMA_STC_LSB1_ADDR A:0x67711428
y.create.l HWIO_LPASS_LPAIF_RDDMA_STC_LSB2_ADDR A:0x67712428
y.create.l HWIO_LPASS_LPAIF_RDDMA_STC_MSB0_ADDR A:0x6771042c
y.create.l HWIO_LPASS_LPAIF_RDDMA_STC_MSB1_ADDR A:0x6771142c
y.create.l HWIO_LPASS_LPAIF_RDDMA_STC_MSB2_ADDR A:0x6771242c
y.create.l HWIO_LPASS_LPAIF_RDDMA_PER0_ADDR A:0x67710430
y.create.l HWIO_LPASS_LPAIF_RDDMA_PER1_ADDR A:0x67711430
y.create.l HWIO_LPASS_LPAIF_RDDMA_PER2_ADDR A:0x67712430
y.create.l HWIO_LPASS_LPAIF_RDDMA_PERCLR0_ADDR A:0x67710434
y.create.l HWIO_LPASS_LPAIF_RDDMA_PERCLR1_ADDR A:0x67711434
y.create.l HWIO_LPASS_LPAIF_RDDMA_PERCLR2_ADDR A:0x67712434
y.create.l HWIO_LPASS_LPAIF_RDDMA_BASE_EXT0_ADDR A:0x67710438
y.create.l HWIO_LPASS_LPAIF_RDDMA_BASE_EXT1_ADDR A:0x67711438
y.create.l HWIO_LPASS_LPAIF_RDDMA_BASE_EXT2_ADDR A:0x67712438
y.create.l HWIO_LPASS_LPAIF_RDDMA_CURR_ADDR_EXT0_ADDR A:0x6771043c
y.create.l HWIO_LPASS_LPAIF_RDDMA_CURR_ADDR_EXT1_ADDR A:0x6771143c
y.create.l HWIO_LPASS_LPAIF_RDDMA_CURR_ADDR_EXT2_ADDR A:0x6771243c
y.create.l HWIO_LPASS_LPAIF_WRDMA_CTL0_ADDR A:0x67713000
y.create.l HWIO_LPASS_LPAIF_WRDMA_CTL1_ADDR A:0x67714000
y.create.l HWIO_LPASS_LPAIF_WRDMA_CTL2_ADDR A:0x67715000
y.create.l HWIO_LPASS_LPAIF_WRDMA_BASE0_ADDR A:0x67713004
y.create.l HWIO_LPASS_LPAIF_WRDMA_BASE1_ADDR A:0x67714004
y.create.l HWIO_LPASS_LPAIF_WRDMA_BASE2_ADDR A:0x67715004
y.create.l HWIO_LPASS_LPAIF_WRDMA_BUFF_LEN0_ADDR A:0x67713008
y.create.l HWIO_LPASS_LPAIF_WRDMA_BUFF_LEN1_ADDR A:0x67714008
y.create.l HWIO_LPASS_LPAIF_WRDMA_BUFF_LEN2_ADDR A:0x67715008
y.create.l HWIO_LPASS_LPAIF_WRDMA_CURR_ADDR0_ADDR A:0x6771300c
y.create.l HWIO_LPASS_LPAIF_WRDMA_CURR_ADDR1_ADDR A:0x6771400c
y.create.l HWIO_LPASS_LPAIF_WRDMA_CURR_ADDR2_ADDR A:0x6771500c
y.create.l HWIO_LPASS_LPAIF_WRDMA_PER_LEN0_ADDR A:0x67713010
y.create.l HWIO_LPASS_LPAIF_WRDMA_PER_LEN1_ADDR A:0x67714010
y.create.l HWIO_LPASS_LPAIF_WRDMA_PER_LEN2_ADDR A:0x67715010
y.create.l HWIO_LPASS_LPAIF_WRDMA_PER_CNT0_ADDR A:0x67713014
y.create.l HWIO_LPASS_LPAIF_WRDMA_PER_CNT1_ADDR A:0x67714014
y.create.l HWIO_LPASS_LPAIF_WRDMA_PER_CNT2_ADDR A:0x67715014
y.create.l HWIO_LPASS_LPAIF_WRDMA_FRM0_ADDR A:0x67713018
y.create.l HWIO_LPASS_LPAIF_WRDMA_FRM1_ADDR A:0x67714018
y.create.l HWIO_LPASS_LPAIF_WRDMA_FRM2_ADDR A:0x67715018
y.create.l HWIO_LPASS_LPAIF_WRDMA_FRMCLR0_ADDR A:0x6771301c
y.create.l HWIO_LPASS_LPAIF_WRDMA_FRMCLR1_ADDR A:0x6771401c
y.create.l HWIO_LPASS_LPAIF_WRDMA_FRMCLR2_ADDR A:0x6771501c
y.create.l HWIO_LPASS_LPAIF_WRDMA_SET_BUFF_CNT0_ADDR A:0x67713020
y.create.l HWIO_LPASS_LPAIF_WRDMA_SET_BUFF_CNT1_ADDR A:0x67714020
y.create.l HWIO_LPASS_LPAIF_WRDMA_SET_BUFF_CNT2_ADDR A:0x67715020
y.create.l HWIO_LPASS_LPAIF_WRDMA_SET_PER_CNT0_ADDR A:0x67713024
y.create.l HWIO_LPASS_LPAIF_WRDMA_SET_PER_CNT1_ADDR A:0x67714024
y.create.l HWIO_LPASS_LPAIF_WRDMA_SET_PER_CNT2_ADDR A:0x67715024
y.create.l HWIO_LPASS_LPAIF_WRDMA_STC_LSB0_ADDR A:0x67713028
y.create.l HWIO_LPASS_LPAIF_WRDMA_STC_LSB1_ADDR A:0x67714028
y.create.l HWIO_LPASS_LPAIF_WRDMA_STC_LSB2_ADDR A:0x67715028
y.create.l HWIO_LPASS_LPAIF_WRDMA_STC_MSB0_ADDR A:0x6771302c
y.create.l HWIO_LPASS_LPAIF_WRDMA_STC_MSB1_ADDR A:0x6771402c
y.create.l HWIO_LPASS_LPAIF_WRDMA_STC_MSB2_ADDR A:0x6771502c
y.create.l HWIO_LPASS_LPAIF_WRDMA_PER0_ADDR A:0x67713030
y.create.l HWIO_LPASS_LPAIF_WRDMA_PER1_ADDR A:0x67714030
y.create.l HWIO_LPASS_LPAIF_WRDMA_PER2_ADDR A:0x67715030
y.create.l HWIO_LPASS_LPAIF_WRDMA_PERCLR0_ADDR A:0x67713034
y.create.l HWIO_LPASS_LPAIF_WRDMA_PERCLR1_ADDR A:0x67714034
y.create.l HWIO_LPASS_LPAIF_WRDMA_PERCLR2_ADDR A:0x67715034
y.create.l HWIO_LPASS_LPAIF_WRDMA_BASE_EXT0_ADDR A:0x67713038
y.create.l HWIO_LPASS_LPAIF_WRDMA_BASE_EXT1_ADDR A:0x67714038
y.create.l HWIO_LPASS_LPAIF_WRDMA_BASE_EXT2_ADDR A:0x67715038
y.create.l HWIO_LPASS_LPAIF_WRDMA_CURR_ADDR_EXT0_ADDR A:0x6771303c
y.create.l HWIO_LPASS_LPAIF_WRDMA_CURR_ADDR_EXT1_ADDR A:0x6771403c
y.create.l HWIO_LPASS_LPAIF_WRDMA_CURR_ADDR_EXT2_ADDR A:0x6771503c
y.create.l HWIO_USB2_HSIC_USB_OTG_HS_ID_ADDR A:0x67c00000
y.create.l HWIO_USB2_HSIC_USB_OTG_HS_HWGENERAL_ADDR A:0x67c00004
y.create.l HWIO_USB2_HSIC_USB_OTG_HS_HWHOST_ADDR A:0x67c00008
y.create.l HWIO_USB2_HSIC_USB_OTG_HS_HWDEVICE_ADDR A:0x67c0000c
y.create.l HWIO_USB2_HSIC_USB_OTG_HS_HWTXBUF_ADDR A:0x67c00010
y.create.l HWIO_USB2_HSIC_USB_OTG_HS_HWRXBUF_ADDR A:0x67c00014
y.create.l HWIO_USB2_HSIC_USB_OTG_HS_SCRATCH_RAM0_ADDR A:0x67c00040
y.create.l HWIO_USB2_HSIC_USB_OTG_HS_SCRATCH_RAM1_ADDR A:0x67c00044
y.create.l HWIO_USB2_HSIC_USB_OTG_HS_SCRATCH_RAM2_ADDR A:0x67c00048
y.create.l HWIO_USB2_HSIC_USB_OTG_HS_SCRATCH_RAM3_ADDR A:0x67c0004c
y.create.l HWIO_USB2_HSIC_USB_OTG_HS_SCRATCH_RAM4_ADDR A:0x67c00050
y.create.l HWIO_USB2_HSIC_USB_OTG_HS_SCRATCH_RAM5_ADDR A:0x67c00054
y.create.l HWIO_USB2_HSIC_USB_OTG_HS_SCRATCH_RAM6_ADDR A:0x67c00058
y.create.l HWIO_USB2_HSIC_USB_OTG_HS_SCRATCH_RAM7_ADDR A:0x67c0005c
y.create.l HWIO_USB2_HSIC_USB_OTG_HS_SCRATCH_RAM8_ADDR A:0x67c00060
y.create.l HWIO_USB2_HSIC_USB_OTG_HS_SCRATCH_RAM9_ADDR A:0x67c00064
y.create.l HWIO_USB2_HSIC_USB_OTG_HS_GPTIMER0LD_ADDR A:0x67c00080
y.create.l HWIO_USB2_HSIC_USB_OTG_HS_GPTIMER0CTRL_ADDR A:0x67c00084
y.create.l HWIO_USB2_HSIC_USB_OTG_HS_GPTIMER1LD_ADDR A:0x67c00088
y.create.l HWIO_USB2_HSIC_USB_OTG_HS_GPTIMER1CTRL_ADDR A:0x67c0008c
y.create.l HWIO_USB2_HSIC_USB_OTG_HS_AHB_BURST_ADDR A:0x67c00090
y.create.l HWIO_USB2_HSIC_USB_OTG_HS_XTOR_STS_ADDR A:0x67c00094
y.create.l HWIO_USB2_HSIC_USB_OTG_HS_AHB_MODE_ADDR A:0x67c00098
y.create.l HWIO_USB2_HSIC_USB_OTG_HS_GEN_CONFIG_ADDR A:0x67c0009c
y.create.l HWIO_USB2_HSIC_USB_OTG_HS_GEN_CONFIG_2_ADDR A:0x67c000a0
y.create.l HWIO_USB2_HSIC_USB_OTG_HS_CAPLENGTH_ADDR A:0x67c00100
y.create.l HWIO_USB2_HSIC_USB_OTG_HS_HCSPARAMS_ADDR A:0x67c00104
y.create.l HWIO_USB2_HSIC_USB_OTG_HS_HCCPARAMS_ADDR A:0x67c00108
y.create.l HWIO_USB2_HSIC_USB_OTG_HS_DCIVERSION_ADDR A:0x67c00120
y.create.l HWIO_USB2_HSIC_USB_OTG_HS_DCCPARAMS_ADDR A:0x67c00124
y.create.l HWIO_USB2_HSIC_USB_OTG_HS_USBCMD_ADDR A:0x67c00140
y.create.l HWIO_USB2_HSIC_USB_OTG_HS_USBSTS_ADDR A:0x67c00144
y.create.l HWIO_USB2_HSIC_USB_OTG_HS_USBINTR_ADDR A:0x67c00148
y.create.l HWIO_USB2_HSIC_USB_OTG_HS_FRINDEX_ADDR A:0x67c0014c
y.create.l HWIO_USB2_HSIC_USB_OTG_HS_PERIODICLISTBASE_ADDR A:0x67c00154
y.create.l HWIO_USB2_HSIC_USB_OTG_HS_DEVICEADDR_ADDR A:0x67c00154
y.create.l HWIO_USB2_HSIC_USB_OTG_HS_ASYNCLISTADDR_ADDR A:0x67c00158
y.create.l HWIO_USB2_HSIC_USB_OTG_HS_ENDPOINTLISTADDR_ADDR A:0x67c00158
y.create.l HWIO_USB2_HSIC_USB_OTG_HS_TTCTRL_ADDR A:0x67c0015c
y.create.l HWIO_USB2_HSIC_USB_OTG_HS_BURSTSIZE_ADDR A:0x67c00160
y.create.l HWIO_USB2_HSIC_USB_OTG_HS_TXFILLTUNING_ADDR A:0x67c00164
y.create.l HWIO_USB2_HSIC_USB_OTG_HS_ULPI_VIEWPORT_ADDR A:0x67c00170
y.create.l HWIO_USB2_HSIC_USB_OTG_HS_ENDPTNAK_ADDR A:0x67c00178
y.create.l HWIO_USB2_HSIC_USB_OTG_HS_ENDPTNAKEN_ADDR A:0x67c0017c
y.create.l HWIO_USB2_HSIC_USB_OTG_HS_PORTSC_ADDR A:0x67c00184
y.create.l HWIO_USB2_HSIC_USB_OTG_HS_OTGSC_ADDR A:0x67c001a4
y.create.l HWIO_USB2_HSIC_USB_OTG_HS_USBMODE_ADDR A:0x67c001a8
y.create.l HWIO_USB2_HSIC_USB_OTG_HS_ENDPTSETUPSTAT_ADDR A:0x67c001ac
y.create.l HWIO_USB2_HSIC_USB_OTG_HS_ENDPTPRIME_ADDR A:0x67c001b0
y.create.l HWIO_USB2_HSIC_USB_OTG_HS_ENDPTFLUSH_ADDR A:0x67c001b4
y.create.l HWIO_USB2_HSIC_USB_OTG_HS_ENDPTSTAT_ADDR A:0x67c001b8
y.create.l HWIO_USB2_HSIC_USB_OTG_HS_ENDPTCOMPLETE_ADDR A:0x67c001bc
y.create.l HWIO_USB2_HSIC_USB_OTG_HS_ENDPTCTRL0_ADDR A:0x67c001c0
y.create.l HWIO_USB2_HSIC_USB_OTG_HS_ENDPTCTRL1_ADDR A:0x67c001c4
y.create.l HWIO_USB2_HSIC_USB_OTG_HS_ENDPTCTRL2_ADDR A:0x67c001c8
y.create.l HWIO_USB2_HSIC_USB_OTG_HS_ENDPTCTRL3_ADDR A:0x67c001cc
y.create.l HWIO_USB2_HSIC_USB_OTG_HS_ENDPTCTRL4_ADDR A:0x67c001d0
y.create.l HWIO_USB2_HSIC_USB_OTG_HS_ENDPTCTRL5_ADDR A:0x67c001d4
y.create.l HWIO_USB2_HSIC_USB_OTG_HS_ENDPTCTRL6_ADDR A:0x67c001d8
y.create.l HWIO_USB2_HSIC_USB_OTG_HS_ENDPTCTRL7_ADDR A:0x67c001dc
y.create.l HWIO_USB2_HSIC_USB_OTG_HS_ENDPTCTRL8_ADDR A:0x67c001e0
y.create.l HWIO_USB2_HSIC_USB_OTG_HS_ENDPTCTRL9_ADDR A:0x67c001e4
y.create.l HWIO_USB2_HSIC_USB_OTG_HS_ENDPTCTRL10_ADDR A:0x67c001e8
y.create.l HWIO_USB2_HSIC_USB_OTG_HS_GENERIC1_ADDR A:0x67c00244
y.create.l HWIO_USB2_HSIC_USB_OTG_HS_GENERIC2_ADDR A:0x67c00248
y.create.l HWIO_USB2_HSIC_USB_OTG_HS_L1_EP_CTRL_ADDR A:0x67c00250
y.create.l HWIO_USB2_HSIC_USB_OTG_HS_L1_CONFIG_ADDR A:0x67c00254
y.create.l HWIO_USB2_HSIC_USB_OTG_HS_LPM_DEBUG_1_ADDR A:0x67c00258
y.create.l HWIO_USB2_HSIC_USB_OTG_HS_LPM_DEBUG_2_ADDR A:0x67c0025c
y.create.l HWIO_USB2_HSIC_USB_OTG_HS_LPM_ATTRIBUTES_ADDR A:0x67c00260
y.create.l HWIO_USB2_HSIC_USB_OTG_HS_LPM_TIMERS_ADDR A:0x67c00264
y.create.l HWIO_USB2_HSIC_USB_OTG_HS_HW_VER_ADDR A:0x67c00270
y.create.l HWIO_USB2_HSIC_USB_OTG_HS_TEST_BUS_ADDR A:0x67c00274
y.create.l HWIO_USB2_HSIC_USB_OTG_HS_BTO_TIME_HS_ADDR A:0x67c00340
y.create.l HWIO_USB2_HSIC_USB_OTG_HS_BTO_TIME_FS_LS_ADDR A:0x67c00344
y.create.l HWIO_USB2_HSIC_USB_OTG_HS_QSB_VALUES_ADDR A:0x67c00348
y.create.l HWIO_USB2_HSIC_USB_OTG_HS_DMA_STUCK_TIMER_ADDR A:0x67c00350
y.create.l HWIO_USB2_HSIC_USB_OTG_HS_SM_OVERRIDE_ADDR A:0x67c00360
y.create.l HWIO_USB2_HSIC_USB_OTG_HS_SM_FENCE_ADDR A:0x67c00364
y.create.l HWIO_USB2_HSIC_USB_OTG_HS_SM_STATE_ADDR A:0x67c00368
y.create.l HWIO_USB2_HSIC_USB_OTG_HS_SPARE_REG_ADDR A:0x67c0036c
y.create.l HWIO_USB2_HSIC_USB_OTG_HS_APF_DBG_CNT_CTRL_ADDR A:0x67c00370
y.create.l HWIO_USB2_HSIC_USB_OTG_HS_APF_DBG_CNT_VAL_ADDR A:0x67c00374
y.create.l HWIO_USB2_HSIC_USB_OTG_HS_APF_DBG_CNT_TRESHOLD_ADDR A:0x67c00378
y.create.l HWIO_USB2_HSIC_USB_OTG_HS_APF_CTRL_ADDR A:0x67c00380
y.create.l HWIO_USB2_HSIC_USB_OTG_HS_APF_DBG_ADDR A:0x67c00384
y.create.l HWIO_USB2_HSIC_USB_OTG_HS_APF_AXI_OVERRIDE_ADDR A:0x67c00388
y.create.l HWIO_USB2_HSIC_USB_OTG_HS_APF_ERR_ADDR_ADDR A:0x67c00390
y.create.l HWIO_USB2_HSIC_USB_OTG_HS_APF_ERR_CTRL_ADDR A:0x67c00394
y.create.l HWIO_USB2_HSIC_USB_OTG_HS_APF_ERR_DATA_LSB_ADDR A:0x67c00398
y.create.l HWIO_USB2_HSIC_USB_OTG_HS_APF_ERR_DATA_MSB_ADDR A:0x67c0039c
y.create.l HWIO_USB2_HSIC_USB_OTG_HS_APF_STS_ADDR A:0x67c003a0
y.create.l HWIO_USB2_HSIC_USB_OTG_HS_APF_STS_CLR_ADDR A:0x67c003a4
y.create.l HWIO_USB2_HSIC_USB_OTG_HS_APF_TIMEOUT_ADDR A:0x67c003a8
y.create.l HWIO_USB2_HSIC_USB_OTG_HS_USBSTS_2_ADDR A:0x67c003c0
y.create.l HWIO_USB2_HSIC_USB_OTG_HS_USBINTR_2_ADDR A:0x67c003c4
y.create.l HWIO_USB2_HSIC_USB_OTG_HS_AHB_STALL_TIMEOUT_ADDR A:0x67c003c8
y.create.l HWIO_USB2_HSIC_USB_OTG_HS_AHB_STALL_ADDR_ADDR A:0x67c003cc
y.create.l HWIO_USB2_PHY_USB_PHY_REVISION_ID0_ADDR A:0x6006c000
y.create.l HWIO_USB2_PHY_USB_PHY_REVISION_ID1_ADDR A:0x6006c004
y.create.l HWIO_USB2_PHY_USB_PHY_REVISION_ID2_ADDR A:0x6006c008
y.create.l HWIO_USB2_PHY_USB_PHY_REVISION_ID3_ADDR A:0x6006c00c
y.create.l HWIO_USB2_PHY_USB_PHY_DEBUG_BUS_STAT0_ADDR A:0x6006c010
y.create.l HWIO_USB2_PHY_USB_PHY_DEBUG_BUS_STAT1_ADDR A:0x6006c014
y.create.l HWIO_USB2_PHY_USB_PHY_DEBUG_BUS_STAT2_ADDR A:0x6006c018
y.create.l HWIO_USB2_PHY_USB_PHY_DEBUG_BUS_STAT3_ADDR A:0x6006c01c
y.create.l HWIO_USB2_PHY_USB_PHY_HS_RX_TESTER_OUT_1_ADDR A:0x6006c020
y.create.l HWIO_USB2_PHY_USB_PHY_CHARGING_DET_OUTPUT_ADDR A:0x6006c024
y.create.l HWIO_USB2_PHY_USB_PHY_HS_PHY_IRQ_STAT_ADDR A:0x6006c028
y.create.l HWIO_USB2_PHY_USB_PHY_HS_PHY_TEST_OUT_1_ADDR A:0x6006c02c
y.create.l HWIO_USB2_PHY_USB_PHY_UTMI_VEC4_STATUS_ADDR A:0x6006c030
y.create.l HWIO_USB2_PHY_USB_PHY_ULPI_VEC0_STATUS_ADDR A:0x6006c034
y.create.l HWIO_USB2_PHY_USB_PHY_ULPI_VEC1_STATUS_ADDR A:0x6006c038
y.create.l HWIO_USB2_PHY_USB_PHY_INTERRUPT_STATUS0_ADDR A:0x6006c03c
y.create.l HWIO_USB2_PHY_USB_PHY_INTERRUPT_STATUS1_ADDR A:0x6006c040
y.create.l HWIO_USB2_PHY_USB_PHY_RX_CHK_ERR_CNT1_STATUS_ADDR A:0x6006c044
y.create.l HWIO_USB2_PHY_USB_PHY_RX_CHK_STATUS_ADDR A:0x6006c048
y.create.l HWIO_USB2_PHY_USB_PHY_REFCLK_RXTAP_TEST_STATUS_ADDR A:0x6006c04c
y.create.l HWIO_USB2_PHY_USB_PHY_UTMI_RX_DATAL_STATUS_ADDR A:0x6006c050
y.create.l HWIO_USB2_PHY_USB_PHY_UTMI_RX_DATAH_STATUS_ADDR A:0x6006c054
y.create.l HWIO_USB2_PHY_USB_PHY_UTMI_RX_PORT_STATUS_ADDR A:0x6006c058
y.create.l HWIO_USB2_PHY_USB_PHY_INTERRUPT_SRC_STATUS_ADDR A:0x6006c05c
y.create.l HWIO_USB2_PHY_USB_PHY_UTMI_CTRL0_ADDR A:0x6006c060
y.create.l HWIO_USB2_PHY_USB_PHY_UTMI_CTRL1_ADDR A:0x6006c064
y.create.l HWIO_USB2_PHY_USB_PHY_UTMI_CTRL2_ADDR A:0x6006c068
y.create.l HWIO_USB2_PHY_USB_PHY_UTMI_CTRL3_ADDR A:0x6006c06c
y.create.l HWIO_USB2_PHY_USB_PHY_UTMI_CTRL4_ADDR A:0x6006c070
y.create.l HWIO_USB2_PHY_USB_PHY_UTMI_CTRL5_ADDR A:0x6006c074
y.create.l HWIO_USB2_PHY_USB_PHY_HS_PHY_CTRL_COMMON0_ADDR A:0x6006c078
y.create.l HWIO_USB2_PHY_USB_PHY_HS_PHY_CTRL_COMMON1_ADDR A:0x6006c07c
y.create.l HWIO_USB2_PHY_USB_PHY_HS_PHY_CTRL_COMMON2_ADDR A:0x6006c080
y.create.l HWIO_USB2_PHY_USB_PHY_HS_PHY_CTRL_COMMON3_ADDR A:0x6006c084
y.create.l HWIO_USB2_PHY_USB_PHY_HS_PHY_CTRL0_ADDR A:0x6006c088
y.create.l HWIO_USB2_PHY_USB_PHY_HS_PHY_CTRL1_ADDR A:0x6006c08c
y.create.l HWIO_USB2_PHY_USB_PHY_HS_PHY_CTRL2_ADDR A:0x6006c090
y.create.l HWIO_USB2_PHY_USB_PHY_HS_PHY_CTRL3_ADDR A:0x6006c094
y.create.l HWIO_USB2_PHY_USB_PHY_PARAMETER_OVERRIDE_X0_ADDR A:0x6006c098
y.create.l HWIO_USB2_PHY_USB_PHY_PARAMETER_OVERRIDE_X1_ADDR A:0x6006c09c
y.create.l HWIO_USB2_PHY_USB_PHY_PARAMETER_OVERRIDE_X2_ADDR A:0x6006c0a0
y.create.l HWIO_USB2_PHY_USB_PHY_PARAMETER_OVERRIDE_X3_ADDR A:0x6006c0a4
y.create.l HWIO_USB2_PHY_USB_PHY_CHARGING_DET_CTRL_ADDR A:0x6006c0a8
y.create.l HWIO_USB2_PHY_USB_PHY_HS_PHY_TEST0_ADDR A:0x6006c0ac
y.create.l HWIO_USB2_PHY_USB_PHY_HS_PHY_TEST1_ADDR A:0x6006c0b0
y.create.l HWIO_USB2_PHY_USB_PHY_HS_RX_TESTER_1_REG0_ADDR A:0x6006c0b4
y.create.l HWIO_USB2_PHY_USB_PHY_HS_RX_TESTER_1_REG1_ADDR A:0x6006c0b8
y.create.l HWIO_USB2_PHY_USB_PHY_HS_RX_TESTER_1_REG3_ADDR A:0x6006c0bc
y.create.l HWIO_USB2_PHY_USB_PHY_TCSR_CTRL_ADDR A:0x6006c0c0
y.create.l HWIO_USB2_PHY_USB_PHY_CFG0_ADDR A:0x6006c0c4
y.create.l HWIO_USB2_PHY_UTMI_PHY_CMN_CTRL0_ADDR A:0x6006c0c8
y.create.l HWIO_USB2_PHY_UTMI_PHY_CMN_CTRL1_ADDR A:0x6006c0cc
y.create.l HWIO_USB2_PHY_USB_PHY_IRQ_CMD_ADDR A:0x6006c0d0
y.create.l HWIO_USB2_PHY_USB_PHY_INTERRUPT_MASK0_ADDR A:0x6006c0d4
y.create.l HWIO_USB2_PHY_USB_PHY_INTERRUPT_MASK1_ADDR A:0x6006c0d8
y.create.l HWIO_USB2_PHY_USB_PHY_INTERRUPT_CLEAR0_ADDR A:0x6006c0dc
y.create.l HWIO_USB2_PHY_USB_PHY_INTERRUPT_CLEAR1_ADDR A:0x6006c0e0
y.create.l HWIO_USB2_PHY_USB_PHY_REFCLK_CTRL_ADDR A:0x6006c0e8
y.create.l HWIO_USB2_PHY_USB_PHY_PWRDOWN_CTRL_ADDR A:0x6006c0ec
y.create.l HWIO_USB2_PHY_USB_PHY_ULPI_OVERRIDE_7_0_ADDR A:0x6006c0f0
y.create.l HWIO_USB2_PHY_USB_PHY_ULPI_OVERRIDE_15_8_ADDR A:0x6006c0f4
y.create.l HWIO_USB2_PHY_USB_PHY_ULPI_OVERRIDE_23_16_ADDR A:0x6006c0f8
y.create.l HWIO_USB2_PHY_USB_PHY_ULPI_OVERRIDE_31_24_ADDR A:0x6006c0fc
y.create.l HWIO_USB2_PHY_USB_PHY_TEST_DEBUG_CTRL_ADDR A:0x6006c104
y.create.l HWIO_USB2_PHY_USB_PHY_RESET_CTRL_ADDR A:0x6006c108
y.create.l HWIO_USB_OTG_HS_ID_ADDR A:0x678d9000
y.create.l HWIO_USB_OTG_HS_HWGENERAL_ADDR A:0x678d9004
y.create.l HWIO_USB_OTG_HS_HWHOST_ADDR A:0x678d9008
y.create.l HWIO_USB_OTG_HS_HWDEVICE_ADDR A:0x678d900c
y.create.l HWIO_USB_OTG_HS_HWTXBUF_ADDR A:0x678d9010
y.create.l HWIO_USB_OTG_HS_HWRXBUF_ADDR A:0x678d9014
y.create.l HWIO_USB_OTG_HS_SCRATCH_RAM0_ADDR A:0x678d9040
y.create.l HWIO_USB_OTG_HS_SCRATCH_RAM1_ADDR A:0x678d9044
y.create.l HWIO_USB_OTG_HS_SCRATCH_RAM2_ADDR A:0x678d9048
y.create.l HWIO_USB_OTG_HS_SCRATCH_RAM3_ADDR A:0x678d904c
y.create.l HWIO_USB_OTG_HS_SCRATCH_RAM4_ADDR A:0x678d9050
y.create.l HWIO_USB_OTG_HS_SCRATCH_RAM5_ADDR A:0x678d9054
y.create.l HWIO_USB_OTG_HS_SCRATCH_RAM6_ADDR A:0x678d9058
y.create.l HWIO_USB_OTG_HS_SCRATCH_RAM7_ADDR A:0x678d905c
y.create.l HWIO_USB_OTG_HS_SCRATCH_RAM8_ADDR A:0x678d9060
y.create.l HWIO_USB_OTG_HS_SCRATCH_RAM9_ADDR A:0x678d9064
y.create.l HWIO_USB_OTG_HS_GPTIMER0LD_ADDR A:0x678d9080
y.create.l HWIO_USB_OTG_HS_GPTIMER0CTRL_ADDR A:0x678d9084
y.create.l HWIO_USB_OTG_HS_GPTIMER1LD_ADDR A:0x678d9088
y.create.l HWIO_USB_OTG_HS_GPTIMER1CTRL_ADDR A:0x678d908c
y.create.l HWIO_USB_OTG_HS_AHB_BURST_ADDR A:0x678d9090
y.create.l HWIO_USB_OTG_HS_XTOR_STS_ADDR A:0x678d9094
y.create.l HWIO_USB_OTG_HS_AHB_MODE_ADDR A:0x678d9098
y.create.l HWIO_USB_OTG_HS_GEN_CONFIG_ADDR A:0x678d909c
y.create.l HWIO_USB_OTG_HS_GEN_CONFIG_2_ADDR A:0x678d90a0
y.create.l HWIO_USB_OTG_HS_CAPLENGTH_ADDR A:0x678d9100
y.create.l HWIO_USB_OTG_HS_HCSPARAMS_ADDR A:0x678d9104
y.create.l HWIO_USB_OTG_HS_HCCPARAMS_ADDR A:0x678d9108
y.create.l HWIO_USB_OTG_HS_DCIVERSION_ADDR A:0x678d9120
y.create.l HWIO_USB_OTG_HS_DCCPARAMS_ADDR A:0x678d9124
y.create.l HWIO_USB_OTG_HS_USBCMD_ADDR A:0x678d9140
y.create.l HWIO_USB_OTG_HS_USBSTS_ADDR A:0x678d9144
y.create.l HWIO_USB_OTG_HS_USBINTR_ADDR A:0x678d9148
y.create.l HWIO_USB_OTG_HS_FRINDEX_ADDR A:0x678d914c
y.create.l HWIO_USB_OTG_HS_PERIODICLISTBASE_ADDR A:0x678d9154
y.create.l HWIO_USB_OTG_HS_DEVICEADDR_ADDR A:0x678d9154
y.create.l HWIO_USB_OTG_HS_ASYNCLISTADDR_ADDR A:0x678d9158
y.create.l HWIO_USB_OTG_HS_ENDPOINTLISTADDR_ADDR A:0x678d9158
y.create.l HWIO_USB_OTG_HS_TTCTRL_ADDR A:0x678d915c
y.create.l HWIO_USB_OTG_HS_BURSTSIZE_ADDR A:0x678d9160
y.create.l HWIO_USB_OTG_HS_TXFILLTUNING_ADDR A:0x678d9164
y.create.l HWIO_USB_OTG_HS_ULPI_VIEWPORT_ADDR A:0x678d9170
y.create.l HWIO_USB_OTG_HS_ENDPTNAK_ADDR A:0x678d9178
y.create.l HWIO_USB_OTG_HS_ENDPTNAKEN_ADDR A:0x678d917c
y.create.l HWIO_USB_OTG_HS_PORTSC_ADDR A:0x678d9184
y.create.l HWIO_USB_OTG_HS_OTGSC_ADDR A:0x678d91a4
y.create.l HWIO_USB_OTG_HS_USBMODE_ADDR A:0x678d91a8
y.create.l HWIO_USB_OTG_HS_ENDPTSETUPSTAT_ADDR A:0x678d91ac
y.create.l HWIO_USB_OTG_HS_ENDPTPRIME_ADDR A:0x678d91b0
y.create.l HWIO_USB_OTG_HS_ENDPTFLUSH_ADDR A:0x678d91b4
y.create.l HWIO_USB_OTG_HS_ENDPTSTAT_ADDR A:0x678d91b8
y.create.l HWIO_USB_OTG_HS_ENDPTCOMPLETE_ADDR A:0x678d91bc
y.create.l HWIO_USB_OTG_HS_ENDPTCTRL0_ADDR A:0x678d91c0
y.create.l HWIO_USB_OTG_HS_ENDPTCTRL1_ADDR A:0x678d91c4
y.create.l HWIO_USB_OTG_HS_ENDPTCTRL2_ADDR A:0x678d91c8
y.create.l HWIO_USB_OTG_HS_ENDPTCTRL3_ADDR A:0x678d91cc
y.create.l HWIO_USB_OTG_HS_ENDPTCTRL4_ADDR A:0x678d91d0
y.create.l HWIO_USB_OTG_HS_ENDPTCTRL5_ADDR A:0x678d91d4
y.create.l HWIO_USB_OTG_HS_ENDPTCTRL6_ADDR A:0x678d91d8
y.create.l HWIO_USB_OTG_HS_ENDPTCTRL7_ADDR A:0x678d91dc
y.create.l HWIO_USB_OTG_HS_ENDPTCTRL8_ADDR A:0x678d91e0
y.create.l HWIO_USB_OTG_HS_ENDPTCTRL9_ADDR A:0x678d91e4
y.create.l HWIO_USB_OTG_HS_ENDPTCTRL10_ADDR A:0x678d91e8
y.create.l HWIO_USB_OTG_HS_ENDPT_PIPE_ID1_ADDR A:0x678d9200
y.create.l HWIO_USB_OTG_HS_ENDPT_PIPE_ID2_ADDR A:0x678d9204
y.create.l HWIO_USB_OTG_HS_ENDPT_PIPE_ID3_ADDR A:0x678d9208
y.create.l HWIO_USB_OTG_HS_ENDPT_PIPE_ID4_ADDR A:0x678d920c
y.create.l HWIO_USB_OTG_HS_ENDPT_PIPE_ID5_ADDR A:0x678d9210
y.create.l HWIO_USB_OTG_HS_ENDPT_PIPE_ID6_ADDR A:0x678d9214
y.create.l HWIO_USB_OTG_HS_ENDPT_PIPE_ID7_ADDR A:0x678d9218
y.create.l HWIO_USB_OTG_HS_ENDPT_PIPE_ID8_ADDR A:0x678d921c
y.create.l HWIO_USB_OTG_HS_ENDPT_PIPE_ID9_ADDR A:0x678d9220
y.create.l HWIO_USB_OTG_HS_ENDPT_PIPE_ID10_ADDR A:0x678d9224
y.create.l HWIO_USB_OTG_HS_PHY_CTRL_ADDR A:0x678d9240
y.create.l HWIO_USB_OTG_HS_GENERIC1_ADDR A:0x678d9244
y.create.l HWIO_USB_OTG_HS_GENERIC2_ADDR A:0x678d9248
y.create.l HWIO_USB_OTG_HS_L1_EP_CTRL_ADDR A:0x678d9250
y.create.l HWIO_USB_OTG_HS_L1_CONFIG_ADDR A:0x678d9254
y.create.l HWIO_USB_OTG_HS_LPM_DEBUG_1_ADDR A:0x678d9258
y.create.l HWIO_USB_OTG_HS_LPM_DEBUG_2_ADDR A:0x678d925c
y.create.l HWIO_USB_OTG_HS_LPM_ATTRIBUTES_ADDR A:0x678d9260
y.create.l HWIO_USB_OTG_HS_LPM_TIMERS_ADDR A:0x678d9264
y.create.l HWIO_USB_OTG_HS_HW_VER_ADDR A:0x678d9270
y.create.l HWIO_USB_OTG_HS_TEST_BUS_ADDR A:0x678d9274
y.create.l HWIO_USB_OTG_HS_PHY_SEC_CTRL_ADDR A:0x678d9278
y.create.l HWIO_USB_OTG_HS_BTO_TIME_HS_ADDR A:0x678d9340
y.create.l HWIO_USB_OTG_HS_BTO_TIME_FS_LS_ADDR A:0x678d9344
y.create.l HWIO_USB_OTG_HS_QSB_VALUES_ADDR A:0x678d9348
y.create.l HWIO_USB_OTG_HS_DMA_STUCK_TIMER_ADDR A:0x678d9350
y.create.l HWIO_USB_OTG_HS_SM_OVERRIDE_ADDR A:0x678d9360
y.create.l HWIO_USB_OTG_HS_SM_FENCE_ADDR A:0x678d9364
y.create.l HWIO_USB_OTG_HS_SM_STATE_ADDR A:0x678d9368
y.create.l HWIO_USB_OTG_HS_SPARE_REG_ADDR A:0x678d936c
y.create.l HWIO_USB_OTG_HS_APF_DBG_CNT_CTRL_ADDR A:0x678d9370
y.create.l HWIO_USB_OTG_HS_APF_DBG_CNT_VAL_ADDR A:0x678d9374
y.create.l HWIO_USB_OTG_HS_APF_DBG_CNT_TRESHOLD_ADDR A:0x678d9378
y.create.l HWIO_USB_OTG_HS_APF_CTRL_ADDR A:0x678d9380
y.create.l HWIO_USB_OTG_HS_APF_DBG_ADDR A:0x678d9384
y.create.l HWIO_USB_OTG_HS_APF_AXI_OVERRIDE_ADDR A:0x678d9388
y.create.l HWIO_USB_OTG_HS_APF_ERR_ADDR_ADDR A:0x678d9390
y.create.l HWIO_USB_OTG_HS_APF_ERR_CTRL_ADDR A:0x678d9394
y.create.l HWIO_USB_OTG_HS_APF_ERR_DATA_LSB_ADDR A:0x678d9398
y.create.l HWIO_USB_OTG_HS_APF_ERR_DATA_MSB_ADDR A:0x678d939c
y.create.l HWIO_USB_OTG_HS_APF_STS_ADDR A:0x678d93a0
y.create.l HWIO_USB_OTG_HS_APF_STS_CLR_ADDR A:0x678d93a4
y.create.l HWIO_USB_OTG_HS_APF_TIMEOUT_ADDR A:0x678d93a8
y.create.l HWIO_USB_OTG_HS_USBSTS_2_ADDR A:0x678d93c0
y.create.l HWIO_USB_OTG_HS_USBINTR_2_ADDR A:0x678d93c4
y.create.l HWIO_USB_OTG_HS_AHB_STALL_TIMEOUT_ADDR A:0x678d93c8
y.create.l HWIO_USB_OTG_HS_AHB_STALL_ADDR_ADDR A:0x678d93cc
y.create.l HWIO_BAM_CTRL_ADDR A:0x678c4000
y.create.l HWIO_BAM_TIMER_ADDR A:0x678c4040
y.create.l HWIO_BAM_TIMER_CTRL_ADDR A:0x678c4044
y.create.l HWIO_BAM_DESC_CNT_TRSHLD_ADDR A:0x678c4008
y.create.l HWIO_BAM_IRQ_STTS_ADDR A:0x678c4014
y.create.l HWIO_BAM_IRQ_CLR_ADDR A:0x678c4018
y.create.l HWIO_BAM_IRQ_EN_ADDR A:0x678c401c
y.create.l HWIO_BAM_CNFG_BITS_ADDR A:0x678c407c
y.create.l HWIO_BAM_CNFG_BITS_2_ADDR A:0x678c4084
y.create.l HWIO_BAM_REVISION_ADDR A:0x678c5000
y.create.l HWIO_BAM_SW_VERSION_ADDR A:0x678c5004
y.create.l HWIO_BAM_NUM_PIPES_ADDR A:0x678c5008
y.create.l HWIO_BAM_TEST_BUS_SEL_ADDR A:0x678c5010
y.create.l HWIO_BAM_TEST_BUS_REG_ADDR A:0x678c5014
y.create.l HWIO_BAM_AHB_MASTER_ERR_CTRLS_ADDR A:0x678c5024
y.create.l HWIO_BAM_AHB_MASTER_ERR_ADDR_ADDR A:0x678c5028
y.create.l HWIO_BAM_AHB_MASTER_ERR_DATA_ADDR A:0x678c502c
y.create.l HWIO_BAM_AHB_MASTER_ERR_ADDR_LSB_ADDR A:0x678c5100
y.create.l HWIO_BAM_AHB_MASTER_ERR_ADDR_MSB_ADDR A:0x678c5104
y.create.l HWIO_BAM_TRUST_REG_ADDR A:0x678c6000
y.create.l HWIO_BAM_P_TRUST_REG0_ADDR A:0x678c6020
y.create.l HWIO_BAM_P_TRUST_REG1_ADDR A:0x678c6024
y.create.l HWIO_BAM_IRQ_SRCS_EE0_ADDR A:0x678c7000
y.create.l HWIO_BAM_IRQ_SRCS_EE1_ADDR A:0x678c8000
y.create.l HWIO_BAM_IRQ_SRCS_EE2_ADDR A:0x678c9000
y.create.l HWIO_BAM_IRQ_SRCS_EE3_ADDR A:0x678ca000
y.create.l HWIO_BAM_IRQ_SRCS_EE4_ADDR A:0x678cb000
y.create.l HWIO_BAM_IRQ_SRCS_EE5_ADDR A:0x678cc000
y.create.l HWIO_BAM_IRQ_SRCS_EE6_ADDR A:0x678cd000
y.create.l HWIO_BAM_IRQ_SRCS_EE7_ADDR A:0x678ce000
y.create.l HWIO_BAM_IRQ_SRCS_MSK_EE0_ADDR A:0x678c7004
y.create.l HWIO_BAM_IRQ_SRCS_MSK_EE1_ADDR A:0x678c8004
y.create.l HWIO_BAM_IRQ_SRCS_MSK_EE2_ADDR A:0x678c9004
y.create.l HWIO_BAM_IRQ_SRCS_MSK_EE3_ADDR A:0x678ca004
y.create.l HWIO_BAM_IRQ_SRCS_MSK_EE4_ADDR A:0x678cb004
y.create.l HWIO_BAM_IRQ_SRCS_MSK_EE5_ADDR A:0x678cc004
y.create.l HWIO_BAM_IRQ_SRCS_MSK_EE6_ADDR A:0x678cd004
y.create.l HWIO_BAM_IRQ_SRCS_MSK_EE7_ADDR A:0x678ce004
y.create.l HWIO_BAM_IRQ_SRCS_UNMASKED_EE0_ADDR A:0x678c7008
y.create.l HWIO_BAM_IRQ_SRCS_UNMASKED_EE1_ADDR A:0x678c8008
y.create.l HWIO_BAM_IRQ_SRCS_UNMASKED_EE2_ADDR A:0x678c9008
y.create.l HWIO_BAM_IRQ_SRCS_UNMASKED_EE3_ADDR A:0x678ca008
y.create.l HWIO_BAM_IRQ_SRCS_UNMASKED_EE4_ADDR A:0x678cb008
y.create.l HWIO_BAM_IRQ_SRCS_UNMASKED_EE5_ADDR A:0x678cc008
y.create.l HWIO_BAM_IRQ_SRCS_UNMASKED_EE6_ADDR A:0x678cd008
y.create.l HWIO_BAM_IRQ_SRCS_UNMASKED_EE7_ADDR A:0x678ce008
y.create.l HWIO_BAM_PIPE_ATTR_EE0_ADDR A:0x678c700c
y.create.l HWIO_BAM_PIPE_ATTR_EE1_ADDR A:0x678c800c
y.create.l HWIO_BAM_PIPE_ATTR_EE2_ADDR A:0x678c900c
y.create.l HWIO_BAM_PIPE_ATTR_EE3_ADDR A:0x678ca00c
y.create.l HWIO_BAM_PIPE_ATTR_EE4_ADDR A:0x678cb00c
y.create.l HWIO_BAM_PIPE_ATTR_EE5_ADDR A:0x678cc00c
y.create.l HWIO_BAM_PIPE_ATTR_EE6_ADDR A:0x678cd00c
y.create.l HWIO_BAM_PIPE_ATTR_EE7_ADDR A:0x678ce00c
y.create.l HWIO_BAM_IRQ_SRCS_ADDR A:0x678c7010
y.create.l HWIO_BAM_IRQ_SRCS_MSK_ADDR A:0x678c7014
y.create.l HWIO_BAM_IRQ_SRCS_UNMASKED_ADDR A:0x678c7018
y.create.l HWIO_BAM_P_CTRL0_ADDR A:0x678d7000
y.create.l HWIO_BAM_P_CTRL1_ADDR A:0x678d8000
y.create.l HWIO_BAM_P_RST0_ADDR A:0x678d7004
y.create.l HWIO_BAM_P_RST1_ADDR A:0x678d8004
y.create.l HWIO_BAM_P_HALT0_ADDR A:0x678d7008
y.create.l HWIO_BAM_P_HALT1_ADDR A:0x678d8008
y.create.l HWIO_BAM_P_IRQ_STTS0_ADDR A:0x678d7010
y.create.l HWIO_BAM_P_IRQ_STTS1_ADDR A:0x678d8010
y.create.l HWIO_BAM_P_IRQ_CLR0_ADDR A:0x678d7014
y.create.l HWIO_BAM_P_IRQ_CLR1_ADDR A:0x678d8014
y.create.l HWIO_BAM_P_IRQ_EN0_ADDR A:0x678d7018
y.create.l HWIO_BAM_P_IRQ_EN1_ADDR A:0x678d8018
y.create.l HWIO_BAM_P_TIMER0_ADDR A:0x678d701c
y.create.l HWIO_BAM_P_TIMER1_ADDR A:0x678d801c
y.create.l HWIO_BAM_P_TIMER_CTRL0_ADDR A:0x678d7020
y.create.l HWIO_BAM_P_TIMER_CTRL1_ADDR A:0x678d8020
y.create.l HWIO_BAM_P_PRDCR_SDBND0_ADDR A:0x678d7024
y.create.l HWIO_BAM_P_PRDCR_SDBND1_ADDR A:0x678d8024
y.create.l HWIO_BAM_P_CNSMR_SDBND0_ADDR A:0x678d7028
y.create.l HWIO_BAM_P_CNSMR_SDBND1_ADDR A:0x678d8028
y.create.l HWIO_BAM_P_SW_OFSTS0_ADDR A:0x678d7800
y.create.l HWIO_BAM_P_SW_OFSTS1_ADDR A:0x678d8800
y.create.l HWIO_BAM_P_AU_PSM_CNTXT_1_0_ADDR A:0x678d7804
y.create.l HWIO_BAM_P_AU_PSM_CNTXT_1_1_ADDR A:0x678d8804
y.create.l HWIO_BAM_P_PSM_CNTXT_2_0_ADDR A:0x678d7808
y.create.l HWIO_BAM_P_PSM_CNTXT_2_1_ADDR A:0x678d8808
y.create.l HWIO_BAM_P_PSM_CNTXT_3_0_ADDR A:0x678d780c
y.create.l HWIO_BAM_P_PSM_CNTXT_3_1_ADDR A:0x678d880c
y.create.l HWIO_BAM_P_PSM_CNTXT_4_0_ADDR A:0x678d7810
y.create.l HWIO_BAM_P_PSM_CNTXT_4_1_ADDR A:0x678d8810
y.create.l HWIO_BAM_P_PSM_CNTXT_5_0_ADDR A:0x678d7814
y.create.l HWIO_BAM_P_PSM_CNTXT_5_1_ADDR A:0x678d8814
y.create.l HWIO_BAM_P_EVNT_REG0_ADDR A:0x678d7818
y.create.l HWIO_BAM_P_EVNT_REG1_ADDR A:0x678d8818
y.create.l HWIO_BAM_P_DESC_FIFO_ADDR0_ADDR A:0x678d781c
y.create.l HWIO_BAM_P_DESC_FIFO_ADDR1_ADDR A:0x678d881c
y.create.l HWIO_BAM_P_FIFO_SIZES0_ADDR A:0x678d7820
y.create.l HWIO_BAM_P_FIFO_SIZES1_ADDR A:0x678d8820
y.create.l HWIO_BAM_P_DATA_FIFO_ADDR0_ADDR A:0x678d7824
y.create.l HWIO_BAM_P_DATA_FIFO_ADDR1_ADDR A:0x678d8824
y.create.l HWIO_BAM_P_EVNT_GEN_TRSHLD0_ADDR A:0x678d7828
y.create.l HWIO_BAM_P_EVNT_GEN_TRSHLD1_ADDR A:0x678d8828
y.create.l HWIO_BAM_P_EVNT_DEST_ADDR0_ADDR A:0x678d782c
y.create.l HWIO_BAM_P_EVNT_DEST_ADDR1_ADDR A:0x678d882c
y.create.l HWIO_BAM_P_DF_CNTXT_0_ADDR A:0x678d7830
y.create.l HWIO_BAM_P_DF_CNTXT_1_ADDR A:0x678d8830
y.create.l HWIO_BAM_P_RETR_CNTXT_0_ADDR A:0x678d7834
y.create.l HWIO_BAM_P_RETR_CNTXT_1_ADDR A:0x678d8834
y.create.l HWIO_BAM_P_SI_CNTXT_0_ADDR A:0x678d7838
y.create.l HWIO_BAM_P_SI_CNTXT_1_ADDR A:0x678d8838
y.create.l HWIO_BAM_P_PSM_CNTXT_3_LSB0_ADDR A:0x678d7900
y.create.l HWIO_BAM_P_PSM_CNTXT_3_LSB1_ADDR A:0x678d8900
y.create.l HWIO_BAM_P_PSM_CNTXT_3_MSB0_ADDR A:0x678d7904
y.create.l HWIO_BAM_P_PSM_CNTXT_3_MSB1_ADDR A:0x678d8904
y.create.l HWIO_BAM_P_DESC_FIFO_ADDR_LSB0_ADDR A:0x678d7910
y.create.l HWIO_BAM_P_DESC_FIFO_ADDR_LSB1_ADDR A:0x678d8910
y.create.l HWIO_BAM_P_DESC_FIFO_ADDR_MSB0_ADDR A:0x678d7914
y.create.l HWIO_BAM_P_DESC_FIFO_ADDR_MSB1_ADDR A:0x678d8914
y.create.l HWIO_BAM_P_DATA_FIFO_ADDR_LSB0_ADDR A:0x678d7920
y.create.l HWIO_BAM_P_DATA_FIFO_ADDR_LSB1_ADDR A:0x678d8920
y.create.l HWIO_BAM_P_DATA_FIFO_ADDR_MSB0_ADDR A:0x678d7924
y.create.l HWIO_BAM_P_DATA_FIFO_ADDR_MSB1_ADDR A:0x678d8924
y.create.l HWIO_BAM_P_EVNT_DEST_ADDR_LSB0_ADDR A:0x678d7930
y.create.l HWIO_BAM_P_EVNT_DEST_ADDR_LSB1_ADDR A:0x678d8930
y.create.l HWIO_BAM_P_EVNT_DEST_ADDR_MSB0_ADDR A:0x678d7934
y.create.l HWIO_BAM_P_EVNT_DEST_ADDR_MSB1_ADDR A:0x678d8934
y.create.l HWIO_XPU_CFG_PCNOC_CFG_XPU_SCR_ADDR A:0x6002e000
y.create.l HWIO_XPU_CFG_PCNOC_CFG_XPU_SWDR_ADDR A:0x6002e004
y.create.l HWIO_XPU_CFG_PCNOC_CFG_XPU_PRTN_RACR_SSHADOW_ADDR A:0x6002e008
y.create.l HWIO_XPU_CFG_PCNOC_CFG_XPU_PRTN_WACR_SSHADOW_ADDR A:0x6002e00c
y.create.l HWIO_XPU_CFG_PCNOC_CFG_XPU_PRTN_START_SSHADOW0_ADDR A:0x6002e010
y.create.l HWIO_XPU_CFG_PCNOC_CFG_XPU_PRTN_END_SSHADOW0_ADDR A:0x6002e018
y.create.l HWIO_XPU_CFG_PCNOC_CFG_XPU_SEAR0_ADDR A:0x6002e040
y.create.l HWIO_XPU_CFG_PCNOC_CFG_XPU_SESR_ADDR A:0x6002e048
y.create.l HWIO_XPU_CFG_PCNOC_CFG_XPU_SESRRESTORE_ADDR A:0x6002e04c
y.create.l HWIO_XPU_CFG_PCNOC_CFG_XPU_SESYNR0_ADDR A:0x6002e050
y.create.l HWIO_XPU_CFG_PCNOC_CFG_XPU_SESYNR1_ADDR A:0x6002e054
y.create.l HWIO_XPU_CFG_PCNOC_CFG_XPU_SESYNR2_ADDR A:0x6002e058
y.create.l HWIO_XPU_CFG_PCNOC_CFG_XPU_MCR_ADDR A:0x6002e100
y.create.l HWIO_XPU_CFG_PCNOC_CFG_XPU_MEAR0_ADDR A:0x6002e140
y.create.l HWIO_XPU_CFG_PCNOC_CFG_XPU_MESR_ADDR A:0x6002e148
y.create.l HWIO_XPU_CFG_PCNOC_CFG_XPU_MESRRESTORE_ADDR A:0x6002e14c
y.create.l HWIO_XPU_CFG_PCNOC_CFG_XPU_MESYNR0_ADDR A:0x6002e150
y.create.l HWIO_XPU_CFG_PCNOC_CFG_XPU_MESYNR1_ADDR A:0x6002e154
y.create.l HWIO_XPU_CFG_PCNOC_CFG_XPU_MESYNR2_ADDR A:0x6002e158
y.create.l HWIO_XPU_CFG_PCNOC_CFG_XPU_CR_ADDR A:0x6002e080
y.create.l HWIO_XPU_CFG_PCNOC_CFG_XPU_PRTN_RACR_SHADOW_ADDR A:0x6002e088
y.create.l HWIO_XPU_CFG_PCNOC_CFG_XPU_PRTN_WACR_SHADOW_ADDR A:0x6002e08c
y.create.l HWIO_XPU_CFG_PCNOC_CFG_XPU_PRTN_START_SHADOW0_ADDR A:0x6002e090
y.create.l HWIO_XPU_CFG_PCNOC_CFG_XPU_PRTN_END_SHADOW0_ADDR A:0x6002e098
y.create.l HWIO_XPU_CFG_PCNOC_CFG_XPU_RPU_ACR0_ADDR A:0x6002e0a0
y.create.l HWIO_XPU_CFG_PCNOC_CFG_XPU_EAR0_ADDR A:0x6002e0c0
y.create.l HWIO_XPU_CFG_PCNOC_CFG_XPU_ESR_ADDR A:0x6002e0c8
y.create.l HWIO_XPU_CFG_PCNOC_CFG_XPU_ESRRESTORE_ADDR A:0x6002e0cc
y.create.l HWIO_XPU_CFG_PCNOC_CFG_XPU_ESYNR0_ADDR A:0x6002e0d0
y.create.l HWIO_XPU_CFG_PCNOC_CFG_XPU_ESYNR1_ADDR A:0x6002e0d4
y.create.l HWIO_XPU_CFG_PCNOC_CFG_XPU_ESYNR2_ADDR A:0x6002e0d8
y.create.l HWIO_XPU_CFG_PCNOC_CFG_XPU_UMR_RACR_ADDR A:0x6002e0e0
y.create.l HWIO_XPU_CFG_PCNOC_CFG_XPU_UMR_WACR_ADDR A:0x6002e0e4
y.create.l HWIO_XPU_CFG_PCNOC_CFG_XPU_UMR_CNTL_ADDR A:0x6002e0f0
y.create.l HWIO_XPU_CFG_PCNOC_CFG_XPU_IDR0_ADDR A:0x6002e074
y.create.l HWIO_XPU_CFG_PCNOC_CFG_XPU_IDR1_ADDR A:0x6002e078
y.create.l HWIO_XPU_CFG_PCNOC_CFG_XPU_REV_ADDR A:0x6002e07c
y.create.l HWIO_XPU_CFG_PCNOC_CFG_XPU_PRT0_RACR0_ADDR A:0x6002e200
y.create.l HWIO_XPU_CFG_PCNOC_CFG_XPU_PRT1_RACR0_ADDR A:0x6002e280
y.create.l HWIO_XPU_CFG_PCNOC_CFG_XPU_PRT2_RACR0_ADDR A:0x6002e300
y.create.l HWIO_XPU_CFG_PCNOC_CFG_XPU_PRT3_RACR0_ADDR A:0x6002e380
y.create.l HWIO_XPU_CFG_PCNOC_CFG_XPU_PRT0_WACR0_ADDR A:0x6002e220
y.create.l HWIO_XPU_CFG_PCNOC_CFG_XPU_PRT1_WACR0_ADDR A:0x6002e2a0
y.create.l HWIO_XPU_CFG_PCNOC_CFG_XPU_PRT2_WACR0_ADDR A:0x6002e320
y.create.l HWIO_XPU_CFG_PCNOC_CFG_XPU_PRT3_WACR0_ADDR A:0x6002e3a0
y.create.l HWIO_XPU_CFG_PCNOC_CFG_XPU_PRT0_START0_ADDR A:0x6002e240
y.create.l HWIO_XPU_CFG_PCNOC_CFG_XPU_PRT1_START0_ADDR A:0x6002e2c0
y.create.l HWIO_XPU_CFG_PCNOC_CFG_XPU_PRT2_START0_ADDR A:0x6002e340
y.create.l HWIO_XPU_CFG_PCNOC_CFG_XPU_PRT3_START0_ADDR A:0x6002e3c0
y.create.l HWIO_XPU_CFG_PCNOC_CFG_XPU_PRT0_END0_ADDR A:0x6002e248
y.create.l HWIO_XPU_CFG_PCNOC_CFG_XPU_PRT1_END0_ADDR A:0x6002e2c8
y.create.l HWIO_XPU_CFG_PCNOC_CFG_XPU_PRT2_END0_ADDR A:0x6002e348
y.create.l HWIO_XPU_CFG_PCNOC_CFG_XPU_PRT3_END0_ADDR A:0x6002e3c8
y.create.l HWIO_XPU_CFG_PCNOC_CFG_XPU_PRT0_SCR_ADDR A:0x6002e250
y.create.l HWIO_XPU_CFG_PCNOC_CFG_XPU_PRT1_SCR_ADDR A:0x6002e2d0
y.create.l HWIO_XPU_CFG_PCNOC_CFG_XPU_PRT2_SCR_ADDR A:0x6002e350
y.create.l HWIO_XPU_CFG_PCNOC_CFG_XPU_PRT3_SCR_ADDR A:0x6002e3d0
y.create.l HWIO_XPU_CFG_PCNOC_CFG_XPU_PRT0_MCR_ADDR A:0x6002e254
y.create.l HWIO_XPU_CFG_PCNOC_CFG_XPU_PRT1_MCR_ADDR A:0x6002e2d4
y.create.l HWIO_XPU_CFG_PCNOC_CFG_XPU_PRT2_MCR_ADDR A:0x6002e354
y.create.l HWIO_XPU_CFG_PCNOC_CFG_XPU_PRT3_MCR_ADDR A:0x6002e3d4
y.create.l HWIO_XPU_CFG_PCNOC_CFG_XPU_PRT0_CNTL0_ADDR A:0x6002e258
y.create.l HWIO_XPU_CFG_PCNOC_CFG_XPU_PRT1_CNTL0_ADDR A:0x6002e2d8
y.create.l HWIO_XPU_CFG_PCNOC_CFG_XPU_PRT2_CNTL0_ADDR A:0x6002e358
y.create.l HWIO_XPU_CFG_PCNOC_CFG_XPU_PRT3_CNTL0_ADDR A:0x6002e3d8
y.create.l HWIO_XPU_CFG_PCNOC_CFG_XPU_PRT0_CNTL1_ADDR A:0x6002e25c
y.create.l HWIO_XPU_CFG_PCNOC_CFG_XPU_PRT1_CNTL1_ADDR A:0x6002e2dc
y.create.l HWIO_XPU_CFG_PCNOC_CFG_XPU_PRT2_CNTL1_ADDR A:0x6002e35c
y.create.l HWIO_XPU_CFG_PCNOC_CFG_XPU_PRT3_CNTL1_ADDR A:0x6002e3dc
y.create.l HWIO_XPU_CFG_PRNG_CFG_XPU_SCR_ADDR A:0x6002f000
y.create.l HWIO_XPU_CFG_PRNG_CFG_XPU_SWDR_ADDR A:0x6002f004
y.create.l HWIO_XPU_CFG_PRNG_CFG_XPU_SEAR0_ADDR A:0x6002f040
y.create.l HWIO_XPU_CFG_PRNG_CFG_XPU_SESR_ADDR A:0x6002f048
y.create.l HWIO_XPU_CFG_PRNG_CFG_XPU_SESRRESTORE_ADDR A:0x6002f04c
y.create.l HWIO_XPU_CFG_PRNG_CFG_XPU_SESYNR0_ADDR A:0x6002f050
y.create.l HWIO_XPU_CFG_PRNG_CFG_XPU_SESYNR1_ADDR A:0x6002f054
y.create.l HWIO_XPU_CFG_PRNG_CFG_XPU_SESYNR2_ADDR A:0x6002f058
y.create.l HWIO_XPU_CFG_PRNG_CFG_XPU_MCR_ADDR A:0x6002f100
y.create.l HWIO_XPU_CFG_PRNG_CFG_XPU_MEAR0_ADDR A:0x6002f140
y.create.l HWIO_XPU_CFG_PRNG_CFG_XPU_MESR_ADDR A:0x6002f148
y.create.l HWIO_XPU_CFG_PRNG_CFG_XPU_MESRRESTORE_ADDR A:0x6002f14c
y.create.l HWIO_XPU_CFG_PRNG_CFG_XPU_MESYNR0_ADDR A:0x6002f150
y.create.l HWIO_XPU_CFG_PRNG_CFG_XPU_MESYNR1_ADDR A:0x6002f154
y.create.l HWIO_XPU_CFG_PRNG_CFG_XPU_MESYNR2_ADDR A:0x6002f158
y.create.l HWIO_XPU_CFG_PRNG_CFG_XPU_CR_ADDR A:0x6002f080
y.create.l HWIO_XPU_CFG_PRNG_CFG_XPU_RPU_ACR0_ADDR A:0x6002f0a0
y.create.l HWIO_XPU_CFG_PRNG_CFG_XPU_EAR0_ADDR A:0x6002f0c0
y.create.l HWIO_XPU_CFG_PRNG_CFG_XPU_ESR_ADDR A:0x6002f0c8
y.create.l HWIO_XPU_CFG_PRNG_CFG_XPU_ESRRESTORE_ADDR A:0x6002f0cc
y.create.l HWIO_XPU_CFG_PRNG_CFG_XPU_ESYNR0_ADDR A:0x6002f0d0
y.create.l HWIO_XPU_CFG_PRNG_CFG_XPU_ESYNR1_ADDR A:0x6002f0d4
y.create.l HWIO_XPU_CFG_PRNG_CFG_XPU_ESYNR2_ADDR A:0x6002f0d8
y.create.l HWIO_XPU_CFG_PRNG_CFG_XPU_IDR0_ADDR A:0x6002f074
y.create.l HWIO_XPU_CFG_PRNG_CFG_XPU_IDR1_ADDR A:0x6002f078
y.create.l HWIO_XPU_CFG_PRNG_CFG_XPU_REV_ADDR A:0x6002f07c
y.create.l HWIO_XPU_CFG_PRNG_CFG_XPU_RG0_RACR0_ADDR A:0x6002f200
y.create.l HWIO_XPU_CFG_PRNG_CFG_XPU_RG0_WACR0_ADDR A:0x6002f220
y.create.l HWIO_XPU_CFG_PRNG_CFG_XPU_RG0_SCR_ADDR A:0x6002f250
y.create.l HWIO_XPU_CFG_PRNG_CFG_XPU_RG0_MCR_ADDR A:0x6002f254
y.create.l HWIO_XPU_CFG_RPM_CFG_XPU_SCR_ADDR A:0x60033000
y.create.l HWIO_XPU_CFG_RPM_CFG_XPU_SWDR_ADDR A:0x60033004
y.create.l HWIO_XPU_CFG_RPM_CFG_XPU_PRTN_RACR_SSHADOW_ADDR A:0x60033008
y.create.l HWIO_XPU_CFG_RPM_CFG_XPU_PRTN_WACR_SSHADOW_ADDR A:0x6003300c
y.create.l HWIO_XPU_CFG_RPM_CFG_XPU_PRTN_START_SSHADOW0_ADDR A:0x60033010
y.create.l HWIO_XPU_CFG_RPM_CFG_XPU_PRTN_END_SSHADOW0_ADDR A:0x60033018
y.create.l HWIO_XPU_CFG_RPM_CFG_XPU_SEAR0_ADDR A:0x60033040
y.create.l HWIO_XPU_CFG_RPM_CFG_XPU_SESR_ADDR A:0x60033048
y.create.l HWIO_XPU_CFG_RPM_CFG_XPU_SESRRESTORE_ADDR A:0x6003304c
y.create.l HWIO_XPU_CFG_RPM_CFG_XPU_SESYNR0_ADDR A:0x60033050
y.create.l HWIO_XPU_CFG_RPM_CFG_XPU_SESYNR1_ADDR A:0x60033054
y.create.l HWIO_XPU_CFG_RPM_CFG_XPU_SESYNR2_ADDR A:0x60033058
y.create.l HWIO_XPU_CFG_RPM_CFG_XPU_MCR_ADDR A:0x60033100
y.create.l HWIO_XPU_CFG_RPM_CFG_XPU_MEAR0_ADDR A:0x60033140
y.create.l HWIO_XPU_CFG_RPM_CFG_XPU_MESR_ADDR A:0x60033148
y.create.l HWIO_XPU_CFG_RPM_CFG_XPU_MESRRESTORE_ADDR A:0x6003314c
y.create.l HWIO_XPU_CFG_RPM_CFG_XPU_MESYNR0_ADDR A:0x60033150
y.create.l HWIO_XPU_CFG_RPM_CFG_XPU_MESYNR1_ADDR A:0x60033154
y.create.l HWIO_XPU_CFG_RPM_CFG_XPU_MESYNR2_ADDR A:0x60033158
y.create.l HWIO_XPU_CFG_RPM_CFG_XPU_CR_ADDR A:0x60033080
y.create.l HWIO_XPU_CFG_RPM_CFG_XPU_PRTN_RACR_SHADOW_ADDR A:0x60033088
y.create.l HWIO_XPU_CFG_RPM_CFG_XPU_PRTN_WACR_SHADOW_ADDR A:0x6003308c
y.create.l HWIO_XPU_CFG_RPM_CFG_XPU_PRTN_START_SHADOW0_ADDR A:0x60033090
y.create.l HWIO_XPU_CFG_RPM_CFG_XPU_PRTN_END_SHADOW0_ADDR A:0x60033098
y.create.l HWIO_XPU_CFG_RPM_CFG_XPU_RPU_ACR0_ADDR A:0x600330a0
y.create.l HWIO_XPU_CFG_RPM_CFG_XPU_EAR0_ADDR A:0x600330c0
y.create.l HWIO_XPU_CFG_RPM_CFG_XPU_ESR_ADDR A:0x600330c8
y.create.l HWIO_XPU_CFG_RPM_CFG_XPU_ESRRESTORE_ADDR A:0x600330cc
y.create.l HWIO_XPU_CFG_RPM_CFG_XPU_ESYNR0_ADDR A:0x600330d0
y.create.l HWIO_XPU_CFG_RPM_CFG_XPU_ESYNR1_ADDR A:0x600330d4
y.create.l HWIO_XPU_CFG_RPM_CFG_XPU_ESYNR2_ADDR A:0x600330d8
y.create.l HWIO_XPU_CFG_RPM_CFG_XPU_UMR_RACR_ADDR A:0x600330e0
y.create.l HWIO_XPU_CFG_RPM_CFG_XPU_UMR_WACR_ADDR A:0x600330e4
y.create.l HWIO_XPU_CFG_RPM_CFG_XPU_UMR_CNTL_ADDR A:0x600330f0
y.create.l HWIO_XPU_CFG_RPM_CFG_XPU_IDR0_ADDR A:0x60033074
y.create.l HWIO_XPU_CFG_RPM_CFG_XPU_IDR1_ADDR A:0x60033078
y.create.l HWIO_XPU_CFG_RPM_CFG_XPU_REV_ADDR A:0x6003307c
y.create.l HWIO_XPU_CFG_RPM_CFG_XPU_PRT0_RACR0_ADDR A:0x60033200
y.create.l HWIO_XPU_CFG_RPM_CFG_XPU_PRT1_RACR0_ADDR A:0x60033280
y.create.l HWIO_XPU_CFG_RPM_CFG_XPU_PRT0_WACR0_ADDR A:0x60033220
y.create.l HWIO_XPU_CFG_RPM_CFG_XPU_PRT1_WACR0_ADDR A:0x600332a0
y.create.l HWIO_XPU_CFG_RPM_CFG_XPU_PRT0_START0_ADDR A:0x60033240
y.create.l HWIO_XPU_CFG_RPM_CFG_XPU_PRT1_START0_ADDR A:0x600332c0
y.create.l HWIO_XPU_CFG_RPM_CFG_XPU_PRT0_END0_ADDR A:0x60033248
y.create.l HWIO_XPU_CFG_RPM_CFG_XPU_PRT1_END0_ADDR A:0x600332c8
y.create.l HWIO_XPU_CFG_RPM_CFG_XPU_PRT0_SCR_ADDR A:0x60033250
y.create.l HWIO_XPU_CFG_RPM_CFG_XPU_PRT1_SCR_ADDR A:0x600332d0
y.create.l HWIO_XPU_CFG_RPM_CFG_XPU_PRT0_MCR_ADDR A:0x60033254
y.create.l HWIO_XPU_CFG_RPM_CFG_XPU_PRT1_MCR_ADDR A:0x600332d4
y.create.l HWIO_XPU_CFG_RPM_CFG_XPU_PRT0_CNTL0_ADDR A:0x60033258
y.create.l HWIO_XPU_CFG_RPM_CFG_XPU_PRT1_CNTL0_ADDR A:0x600332d8
y.create.l HWIO_XPU_CFG_RPM_CFG_XPU_PRT0_CNTL1_ADDR A:0x6003325c
y.create.l HWIO_XPU_CFG_RPM_CFG_XPU_PRT1_CNTL1_ADDR A:0x600332dc
y.create.done
