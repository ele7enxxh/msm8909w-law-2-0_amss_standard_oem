y.create.l HWIO_APCS_GICD_CTLR_ADDR A:0x6b000000
y.create.l HWIO_APCS_GICD_TYPER_ADDR A:0x6b000004
y.create.l HWIO_APCS_GICD_IIDR_ADDR A:0x6b000008
y.create.l HWIO_APCS_GICD_ANSACR_ADDR A:0x6b000020
y.create.l HWIO_APCS_GICD_CGCR_ADDR A:0x6b000024
y.create.l HWIO_APCS_GICD_HW_VERSION_ADDR A:0x6b000030
y.create.l HWIO_APCS_GICD_ISR0_ADDR A:0x6b000080
y.create.l HWIO_APCS_GICD_ISR1_ADDR A:0x6b000084
y.create.l HWIO_APCS_GICD_ISR2_ADDR A:0x6b000088
y.create.l HWIO_APCS_GICD_ISR3_ADDR A:0x6b00008c
y.create.l HWIO_APCS_GICD_ISR4_ADDR A:0x6b000090
y.create.l HWIO_APCS_GICD_ISR5_ADDR A:0x6b000094
y.create.l HWIO_APCS_GICD_ISR6_ADDR A:0x6b000098
y.create.l HWIO_APCS_GICD_ISR7_ADDR A:0x6b00009c
y.create.l HWIO_APCS_GICD_ISR8_ADDR A:0x6b0000a0
y.create.l HWIO_APCS_GICD_ISENABLER0_ADDR A:0x6b000100
y.create.l HWIO_APCS_GICD_ISENABLER1_ADDR A:0x6b000104
y.create.l HWIO_APCS_GICD_ISENABLER2_ADDR A:0x6b000108
y.create.l HWIO_APCS_GICD_ISENABLER3_ADDR A:0x6b00010c
y.create.l HWIO_APCS_GICD_ISENABLER4_ADDR A:0x6b000110
y.create.l HWIO_APCS_GICD_ISENABLER5_ADDR A:0x6b000114
y.create.l HWIO_APCS_GICD_ISENABLER6_ADDR A:0x6b000118
y.create.l HWIO_APCS_GICD_ISENABLER7_ADDR A:0x6b00011c
y.create.l HWIO_APCS_GICD_ISENABLER8_ADDR A:0x6b000120
y.create.l HWIO_APCS_GICD_ICENABLER0_ADDR A:0x6b000180
y.create.l HWIO_APCS_GICD_ICENABLER1_ADDR A:0x6b000184
y.create.l HWIO_APCS_GICD_ICENABLER2_ADDR A:0x6b000188
y.create.l HWIO_APCS_GICD_ICENABLER3_ADDR A:0x6b00018c
y.create.l HWIO_APCS_GICD_ICENABLER4_ADDR A:0x6b000190
y.create.l HWIO_APCS_GICD_ICENABLER5_ADDR A:0x6b000194
y.create.l HWIO_APCS_GICD_ICENABLER6_ADDR A:0x6b000198
y.create.l HWIO_APCS_GICD_ICENABLER7_ADDR A:0x6b00019c
y.create.l HWIO_APCS_GICD_ICENABLER8_ADDR A:0x6b0001a0
y.create.l HWIO_APCS_GICD_ISPENDR0_ADDR A:0x6b000200
y.create.l HWIO_APCS_GICD_ISPENDR1_ADDR A:0x6b000204
y.create.l HWIO_APCS_GICD_ISPENDR2_ADDR A:0x6b000208
y.create.l HWIO_APCS_GICD_ISPENDR3_ADDR A:0x6b00020c
y.create.l HWIO_APCS_GICD_ISPENDR4_ADDR A:0x6b000210
y.create.l HWIO_APCS_GICD_ISPENDR5_ADDR A:0x6b000214
y.create.l HWIO_APCS_GICD_ISPENDR6_ADDR A:0x6b000218
y.create.l HWIO_APCS_GICD_ISPENDR7_ADDR A:0x6b00021c
y.create.l HWIO_APCS_GICD_ISPENDR8_ADDR A:0x6b000220
y.create.l HWIO_APCS_GICD_ICPENDR0_ADDR A:0x6b000280
y.create.l HWIO_APCS_GICD_ICPENDR1_ADDR A:0x6b000284
y.create.l HWIO_APCS_GICD_ICPENDR2_ADDR A:0x6b000288
y.create.l HWIO_APCS_GICD_ICPENDR3_ADDR A:0x6b00028c
y.create.l HWIO_APCS_GICD_ICPENDR4_ADDR A:0x6b000290
y.create.l HWIO_APCS_GICD_ICPENDR5_ADDR A:0x6b000294
y.create.l HWIO_APCS_GICD_ICPENDR6_ADDR A:0x6b000298
y.create.l HWIO_APCS_GICD_ICPENDR7_ADDR A:0x6b00029c
y.create.l HWIO_APCS_GICD_ICPENDR8_ADDR A:0x6b0002a0
y.create.l HWIO_APCS_GICD_ISACTIVER0_ADDR A:0x6b000300
y.create.l HWIO_APCS_GICD_ISACTIVER1_ADDR A:0x6b000304
y.create.l HWIO_APCS_GICD_ISACTIVER2_ADDR A:0x6b000308
y.create.l HWIO_APCS_GICD_ISACTIVER3_ADDR A:0x6b00030c
y.create.l HWIO_APCS_GICD_ISACTIVER4_ADDR A:0x6b000310
y.create.l HWIO_APCS_GICD_ISACTIVER5_ADDR A:0x6b000314
y.create.l HWIO_APCS_GICD_ISACTIVER6_ADDR A:0x6b000318
y.create.l HWIO_APCS_GICD_ISACTIVER7_ADDR A:0x6b00031c
y.create.l HWIO_APCS_GICD_ISACTIVER8_ADDR A:0x6b000320
y.create.l HWIO_APCS_GICD_ICACTIVER0_ADDR A:0x6b000380
y.create.l HWIO_APCS_GICD_ICACTIVER1_ADDR A:0x6b000384
y.create.l HWIO_APCS_GICD_ICACTIVER2_ADDR A:0x6b000388
y.create.l HWIO_APCS_GICD_ICACTIVER3_ADDR A:0x6b00038c
y.create.l HWIO_APCS_GICD_ICACTIVER4_ADDR A:0x6b000390
y.create.l HWIO_APCS_GICD_ICACTIVER5_ADDR A:0x6b000394
y.create.l HWIO_APCS_GICD_ICACTIVER6_ADDR A:0x6b000398
y.create.l HWIO_APCS_GICD_ICACTIVER7_ADDR A:0x6b00039c
y.create.l HWIO_APCS_GICD_ICACTIVER8_ADDR A:0x6b0003a0
y.create.l HWIO_APCS_GICD_IPRIORITYR0_ADDR A:0x6b000400
y.create.l HWIO_APCS_GICD_IPRIORITYR1_ADDR A:0x6b000404
y.create.l HWIO_APCS_GICD_IPRIORITYR2_ADDR A:0x6b000408
y.create.l HWIO_APCS_GICD_IPRIORITYR3_ADDR A:0x6b00040c
y.create.l HWIO_APCS_GICD_IPRIORITYR4_ADDR A:0x6b000410
y.create.l HWIO_APCS_GICD_IPRIORITYR5_ADDR A:0x6b000414
y.create.l HWIO_APCS_GICD_IPRIORITYR6_ADDR A:0x6b000418
y.create.l HWIO_APCS_GICD_IPRIORITYR7_ADDR A:0x6b00041c
y.create.l HWIO_APCS_GICD_IPRIORITYR8_ADDR A:0x6b000420
y.create.l HWIO_APCS_GICD_IPRIORITYR9_ADDR A:0x6b000424
y.create.l HWIO_APCS_GICD_ITARGETSR0_ADDR A:0x6b000800
y.create.l HWIO_APCS_GICD_ITARGETSR1_ADDR A:0x6b000804
y.create.l HWIO_APCS_GICD_ITARGETSR2_ADDR A:0x6b000808
y.create.l HWIO_APCS_GICD_ITARGETSR3_ADDR A:0x6b00080c
y.create.l HWIO_APCS_GICD_ITARGETSR4_ADDR A:0x6b000810
y.create.l HWIO_APCS_GICD_ITARGETSR5_ADDR A:0x6b000814
y.create.l HWIO_APCS_GICD_ITARGETSR6_ADDR A:0x6b000818
y.create.l HWIO_APCS_GICD_ITARGETSR7_ADDR A:0x6b00081c
y.create.l HWIO_APCS_GICD_ITARGETSR8_ADDR A:0x6b000820
y.create.l HWIO_APCS_GICD_ITARGETSR9_ADDR A:0x6b000824
y.create.l HWIO_APCS_GICD_ICFGR0_ADDR A:0x6b000c00
y.create.l HWIO_APCS_GICD_ICFGR1_ADDR A:0x6b000c04
y.create.l HWIO_APCS_GICD_ICFGR2_ADDR A:0x6b000c08
y.create.l HWIO_APCS_GICD_ICFGR3_ADDR A:0x6b000c0c
y.create.l HWIO_APCS_GICD_ICFGR4_ADDR A:0x6b000c10
y.create.l HWIO_APCS_GICD_ICFGR5_ADDR A:0x6b000c14
y.create.l HWIO_APCS_GICD_ICFGR6_ADDR A:0x6b000c18
y.create.l HWIO_APCS_GICD_ICFGR7_ADDR A:0x6b000c1c
y.create.l HWIO_APCS_GICD_ICFGR8_ADDR A:0x6b000c20
y.create.l HWIO_APCS_GICD_ICFGR9_ADDR A:0x6b000c24
y.create.l HWIO_APCS_GICD_SGIR_ADDR A:0x6b000f00
y.create.l HWIO_APCS_GICD_CPENDSGIR0_ADDR A:0x6b000f10
y.create.l HWIO_APCS_GICD_CPENDSGIR1_ADDR A:0x6b000f14
y.create.l HWIO_APCS_GICD_CPENDSGIR2_ADDR A:0x6b000f18
y.create.l HWIO_APCS_GICD_CPENDSGIR3_ADDR A:0x6b000f1c
y.create.l HWIO_APCS_GICD_SPENDSGIR0_ADDR A:0x6b000f20
y.create.l HWIO_APCS_GICD_SPENDSGIR1_ADDR A:0x6b000f24
y.create.l HWIO_APCS_GICD_SPENDSGIR2_ADDR A:0x6b000f28
y.create.l HWIO_APCS_GICD_SPENDSGIR3_ADDR A:0x6b000f2c
y.create.l HWIO_APCS_GICD_PIDR0_ADDR A:0x6b000fd0
y.create.l HWIO_APCS_GICD_PIDR1_ADDR A:0x6b000fd4
y.create.l HWIO_APCS_GICD_PIDR2_ADDR A:0x6b000fd8
y.create.l HWIO_APCS_GICD_PIDR3_ADDR A:0x6b000fdc
y.create.l HWIO_APCS_GICD_PIDR4_ADDR A:0x6b000fe0
y.create.l HWIO_APCS_GICD_PIDR5_ADDR A:0x6b000fe4
y.create.l HWIO_APCS_GICD_PIDR6_ADDR A:0x6b000fe8
y.create.l HWIO_APCS_GICD_PIDR7_ADDR A:0x6b000fec
y.create.l HWIO_APCS_GICD_CIDR0_ADDR A:0x6b000ff0
y.create.l HWIO_APCS_GICD_CIDR1_ADDR A:0x6b000ff4
y.create.l HWIO_APCS_GICD_CIDR2_ADDR A:0x6b000ff8
y.create.l HWIO_APCS_GICD_CIDR3_ADDR A:0x6b000ffc
y.create.l HWIO_APCS_GICH_HCR_ADDR A:0x6b001000
y.create.l HWIO_APCS_GICH_VTR_ADDR A:0x6b001004
y.create.l HWIO_APCS_GICH_VMCR_ADDR A:0x6b001008
y.create.l HWIO_APCS_GICH_MISR_ADDR A:0x6b001010
y.create.l HWIO_APCS_GICH_EISR_ADDR A:0x6b001020
y.create.l HWIO_APCS_GICH_ELRSR_ADDR A:0x6b001030
y.create.l HWIO_APCS_GICH_APR_ADDR A:0x6b0010f0
y.create.l HWIO_APCS_GICH_LR0_ADDR A:0x6b001100
y.create.l HWIO_APCS_GICH_LR1_ADDR A:0x6b001104
y.create.l HWIO_APCS_GICH_LR2_ADDR A:0x6b001108
y.create.l HWIO_APCS_GICH_LR3_ADDR A:0x6b00110c
y.create.l HWIO_APCS_GICH_SW_LR_ADDR A:0x6b001120
y.create.l HWIO_APCS_GICC_CTLR_ADDR A:0x6b002000
y.create.l HWIO_APCS_GICC_PMR_ADDR A:0x6b002004
y.create.l HWIO_APCS_GICC_BPR_ADDR A:0x6b002008
y.create.l HWIO_APCS_GICC_IAR_ADDR A:0x6b00200c
y.create.l HWIO_APCS_GICC_EOIR_ADDR A:0x6b002010
y.create.l HWIO_APCS_GICC_RPR_ADDR A:0x6b002014
y.create.l HWIO_APCS_GICC_HPPIR_ADDR A:0x6b002018
y.create.l HWIO_APCS_GICC_ABPR_ADDR A:0x6b00201c
y.create.l HWIO_APCS_GICC_AIAR_ADDR A:0x6b002020
y.create.l HWIO_APCS_GICC_AEOIR_ADDR A:0x6b002024
y.create.l HWIO_APCS_GICC_AHPPIR_ADDR A:0x6b002028
y.create.l HWIO_APCS_GICC_APR_ADDR A:0x6b0020d0
y.create.l HWIO_APCS_GICC_NSAPR_ADDR A:0x6b0020e0
y.create.l HWIO_APCS_GICC_IIDR_ADDR A:0x6b0020fc
y.create.l HWIO_APCS_GICC_DIR_ADDR A:0x6b003000
y.create.l HWIO_APCS_GICV_CTLR_ADDR A:0x6b004000
y.create.l HWIO_APCS_GICV_PMR_ADDR A:0x6b004004
y.create.l HWIO_APCS_GICV_BPR_ADDR A:0x6b004008
y.create.l HWIO_APCS_GICV_IAR_ADDR A:0x6b00400c
y.create.l HWIO_APCS_GICV_EOIR_ADDR A:0x6b004010
y.create.l HWIO_APCS_GICV_RPR_ADDR A:0x6b004014
y.create.l HWIO_APCS_GICV_HPPIR_ADDR A:0x6b004018
y.create.l HWIO_APCS_GICV_ABPR_ADDR A:0x6b00401c
y.create.l HWIO_APCS_GICV_AIAR_ADDR A:0x6b004020
y.create.l HWIO_APCS_GICV_AEOIR_ADDR A:0x6b004024
y.create.l HWIO_APCS_GICV_AHPPIR_ADDR A:0x6b004028
y.create.l HWIO_APCS_GICV_APR_ADDR A:0x6b0040d0
y.create.l HWIO_APCS_GICV_IIDR_ADDR A:0x6b0040fc
y.create.l HWIO_APCS_GICV_DIR_ADDR A:0x6b005000
y.create.l HWIO_APCS_ACCSECURE_ADDR A:0x6b008000
y.create.l HWIO_APCS_CPU_PWR_CTL_ADDR A:0x6b008004
y.create.l HWIO_APCS_ACC_STS_ADDR A:0x6b008008
y.create.l HWIO_APCS_ATSTBUS_SEL_ADDR A:0x6b00800c
y.create.l HWIO_APCS_CPU_TRGTD_DBG_RST_ADDR A:0x6b008010
y.create.l HWIO_APCS_CPU_AUX_CLK_SEL_ADDR A:0x6b008014
y.create.l HWIO_APCS_CPU_PLL_MODE_ADDR A:0x6b008018
y.create.l HWIO_APCS_CPU_PLL_L_VAL_ADDR A:0x6b00801c
y.create.l HWIO_APCS_CPU_PLL_ALPHA_VAL_ADDR A:0x6b008020
y.create.l HWIO_APCS_CPU_PLL_ALPHA_VAL_U_ADDR A:0x6b008024
y.create.l HWIO_APCS_CPU_PLL_USER_CTL_ADDR A:0x6b008028
y.create.l HWIO_APCS_CPU_PLL_USER_CTL_U_ADDR A:0x6b00802c
y.create.l HWIO_APCS_CPU_PLL_CONFIG_CTL_ADDR A:0x6b008030
y.create.l HWIO_APCS_CPU_PLL_TEST_CTL_ADDR A:0x6b008034
y.create.l HWIO_APCS_CPU_PLL_TEST_CTL_U_ADDR A:0x6b008038
y.create.l HWIO_APCS_CPU_PLL_STATUS_ADDR A:0x6b00803c
y.create.l HWIO_APCS_CPU_PLL_FREQ_CTL_ADDR A:0x6b008040
y.create.l HWIO_APCS_TZIPC_INTERRUPT_ADDR A:0x6b008044
y.create.l HWIO_APCS_A7_CFG_ADDR A:0x6b008048
y.create.l HWIO_GCC_DBG_CLK_ON_REQ_ADDR A:0x6b00804c
y.create.l HWIO_APCS_SAW2_SECURE_ADDR A:0x6b009000
y.create.l HWIO_APCS_SAW2_ID_ADDR A:0x6b009004
y.create.l HWIO_APCS_SAW2_CFG_ADDR A:0x6b009008
y.create.l HWIO_APCS_SAW2_SPM_STS_ADDR A:0x6b00900c
y.create.l HWIO_APCS_SAW2_AVS_STS_ADDR A:0x6b009010
y.create.l HWIO_APCS_SAW2_PMIC_STS_ADDR A:0x6b009014
y.create.l HWIO_APCS_SAW2_RST_ADDR A:0x6b009018
y.create.l HWIO_APCS_SAW2_SPM_CTL_ADDR A:0x6b009030
y.create.l HWIO_APCS_SAW2_SPM_DLY_ADDR A:0x6b009034
y.create.l HWIO_APCS_SAW2_SPM_STS2_ADDR A:0x6b009038
y.create.l HWIO_APCS_SAW2_SPM_SLP_SEQ_ENTRY_0_ADDR A:0x6b009400
y.create.l HWIO_APCS_SAW2_SPM_SLP_SEQ_ENTRY_1_ADDR A:0x6b009404
y.create.l HWIO_APCS_SAW2_SPM_SLP_SEQ_ENTRY_2_ADDR A:0x6b009408
y.create.l HWIO_APCS_SAW2_SPM_SLP_SEQ_ENTRY_3_ADDR A:0x6b00940c
y.create.l HWIO_APCS_SAW2_SPM_SLP_SEQ_ENTRY_4_ADDR A:0x6b009410
y.create.l HWIO_APCS_SAW2_SPM_SLP_SEQ_ENTRY_5_ADDR A:0x6b009414
y.create.l HWIO_APCS_SAW2_SPM_SLP_SEQ_ENTRY_6_ADDR A:0x6b009418
y.create.l HWIO_APCS_SAW2_SPM_SLP_SEQ_ENTRY_7_ADDR A:0x6b00941c
y.create.l HWIO_APCS_SAW2_SPM_SLP_SEQ_ENTRY_8_ADDR A:0x6b009420
y.create.l HWIO_APCS_SAW2_SPM_SLP_SEQ_ENTRY_9_ADDR A:0x6b009424
y.create.l HWIO_APCS_SAW2_VERSION_ADDR A:0x6b009fd0
y.create.l HWIO_QTMR_AC_CNTFRQ_ADDR A:0x6b020000
y.create.l HWIO_QTMR_AC_CNTSR_ADDR A:0x6b020004
y.create.l HWIO_QTMR_AC_CNTTID_ADDR A:0x6b020008
y.create.l HWIO_QTMR_AC_CNTACR_0_ADDR A:0x6b020040
y.create.l HWIO_QTMR_AC_CNTACR_1_ADDR A:0x6b020044
y.create.l HWIO_QTMR_AC_CNTACR_2_ADDR A:0x6b020048
y.create.l HWIO_QTMR_AC_CNTACR_3_ADDR A:0x6b02004c
y.create.l HWIO_QTMR_AC_CNTACR_4_ADDR A:0x6b020050
y.create.l HWIO_QTMR_AC_CNTACR_5_ADDR A:0x6b020054
y.create.l HWIO_QTMR_AC_CNTACR_6_ADDR A:0x6b020058
y.create.l HWIO_QTMR_AC_CNTACR_7_ADDR A:0x6b02005c
y.create.l HWIO_QTMR_AC_CNTVOFF_LO_0_ADDR A:0x6b020080
y.create.l HWIO_QTMR_AC_CNTVOFF_LO_1_ADDR A:0x6b020088
y.create.l HWIO_QTMR_AC_CNTVOFF_LO_2_ADDR A:0x6b020090
y.create.l HWIO_QTMR_AC_CNTVOFF_LO_3_ADDR A:0x6b020098
y.create.l HWIO_QTMR_AC_CNTVOFF_LO_4_ADDR A:0x6b0200a0
y.create.l HWIO_QTMR_AC_CNTVOFF_LO_5_ADDR A:0x6b0200a8
y.create.l HWIO_QTMR_AC_CNTVOFF_LO_6_ADDR A:0x6b0200b0
y.create.l HWIO_QTMR_AC_CNTVOFF_LO_7_ADDR A:0x6b0200b8
y.create.l HWIO_QTMR_AC_CNTVOFF_HI_0_ADDR A:0x6b020084
y.create.l HWIO_QTMR_AC_CNTVOFF_HI_1_ADDR A:0x6b02008c
y.create.l HWIO_QTMR_AC_CNTVOFF_HI_2_ADDR A:0x6b020094
y.create.l HWIO_QTMR_AC_CNTVOFF_HI_3_ADDR A:0x6b02009c
y.create.l HWIO_QTMR_AC_CNTVOFF_HI_4_ADDR A:0x6b0200a4
y.create.l HWIO_QTMR_AC_CNTVOFF_HI_5_ADDR A:0x6b0200ac
y.create.l HWIO_QTMR_AC_CNTVOFF_HI_6_ADDR A:0x6b0200b4
y.create.l HWIO_QTMR_AC_CNTVOFF_HI_7_ADDR A:0x6b0200bc
y.create.l HWIO_QTMR_AC_CFG_ADDR A:0x6b020fc0
y.create.l HWIO_QTMR_AC_VERSION_ADDR A:0x6b020fd0
y.create.l HWIO_APCS_F0_QTMR_V1_CNTPCT_LO_ADDR A:0x6b021000
y.create.l HWIO_APCS_F0_QTMR_V1_CNTPCT_HI_ADDR A:0x6b021004
y.create.l HWIO_APCS_F0_QTMR_V1_CNTVCT_LO_ADDR A:0x6b021008
y.create.l HWIO_APCS_F0_QTMR_V1_CNTVCT_HI_ADDR A:0x6b02100c
y.create.l HWIO_APCS_F0_QTMR_V1_CNTFRQ_ADDR A:0x6b021010
y.create.l HWIO_APCS_F0_QTMR_V1_CNTPL0ACR_ADDR A:0x6b021014
y.create.l HWIO_APCS_F0_QTMR_V1_CNTVOFF_LO_ADDR A:0x6b021018
y.create.l HWIO_APCS_F0_QTMR_V1_CNTVOFF_HI_ADDR A:0x6b02101c
y.create.l HWIO_APCS_F0_QTMR_V1_CNTP_CVAL_LO_ADDR A:0x6b021020
y.create.l HWIO_APCS_F0_QTMR_V1_CNTP_CVAL_HI_ADDR A:0x6b021024
y.create.l HWIO_APCS_F0_QTMR_V1_CNTP_TVAL_ADDR A:0x6b021028
y.create.l HWIO_APCS_F0_QTMR_V1_CNTP_CTL_ADDR A:0x6b02102c
y.create.l HWIO_APCS_F0_QTMR_V1_CNTV_CVAL_LO_ADDR A:0x6b021030
y.create.l HWIO_APCS_F0_QTMR_V1_CNTV_CVAL_HI_ADDR A:0x6b021034
y.create.l HWIO_APCS_F0_QTMR_V1_CNTV_TVAL_ADDR A:0x6b021038
y.create.l HWIO_APCS_F0_QTMR_V1_CNTV_CTL_ADDR A:0x6b02103c
y.create.l HWIO_APCS_F0_QTMR_V1_VERSION_ADDR A:0x6b021fd0
y.create.l HWIO_APCS_F0_QTMR_V2_CNTPCT_LO_ADDR A:0x6b022000
y.create.l HWIO_APCS_F0_QTMR_V2_CNTPCT_HI_ADDR A:0x6b022004
y.create.l HWIO_APCS_F0_QTMR_V2_CNTVCT_LO_ADDR A:0x6b022008
y.create.l HWIO_APCS_F0_QTMR_V2_CNTVCT_HI_ADDR A:0x6b02200c
y.create.l HWIO_APCS_F0_QTMR_V2_CNTFRQ_ADDR A:0x6b022010
y.create.l HWIO_APCS_F0_QTMR_V2_CNTP_CVAL_LO_ADDR A:0x6b022020
y.create.l HWIO_APCS_F0_QTMR_V2_CNTP_CVAL_HI_ADDR A:0x6b022024
y.create.l HWIO_APCS_F0_QTMR_V2_CNTP_TVAL_ADDR A:0x6b022028
y.create.l HWIO_APCS_F0_QTMR_V2_CNTP_CTL_ADDR A:0x6b02202c
y.create.l HWIO_APCS_F0_QTMR_V2_CNTV_CVAL_LO_ADDR A:0x6b022030
y.create.l HWIO_APCS_F0_QTMR_V2_CNTV_CVAL_HI_ADDR A:0x6b022034
y.create.l HWIO_APCS_F0_QTMR_V2_CNTV_TVAL_ADDR A:0x6b022038
y.create.l HWIO_APCS_F0_QTMR_V2_CNTV_CTL_ADDR A:0x6b02203c
y.create.l HWIO_APCS_F0_QTMR_V2_VERSION_ADDR A:0x6b022fd0
y.create.l HWIO_APCS_F1_QTMR_V1_CNTPCT_LO_ADDR A:0x6b023000
y.create.l HWIO_APCS_F1_QTMR_V1_CNTPCT_HI_ADDR A:0x6b023004
y.create.l HWIO_APCS_F1_QTMR_V1_CNTVCT_LO_ADDR A:0x6b023008
y.create.l HWIO_APCS_F1_QTMR_V1_CNTVCT_HI_ADDR A:0x6b02300c
y.create.l HWIO_APCS_F1_QTMR_V1_CNTFRQ_ADDR A:0x6b023010
y.create.l HWIO_APCS_F1_QTMR_V1_CNTPL0ACR_ADDR A:0x6b023014
y.create.l HWIO_APCS_F1_QTMR_V1_CNTVOFF_LO_ADDR A:0x6b023018
y.create.l HWIO_APCS_F1_QTMR_V1_CNTVOFF_HI_ADDR A:0x6b02301c
y.create.l HWIO_APCS_F1_QTMR_V1_CNTP_CVAL_LO_ADDR A:0x6b023020
y.create.l HWIO_APCS_F1_QTMR_V1_CNTP_CVAL_HI_ADDR A:0x6b023024
y.create.l HWIO_APCS_F1_QTMR_V1_CNTP_TVAL_ADDR A:0x6b023028
y.create.l HWIO_APCS_F1_QTMR_V1_CNTP_CTL_ADDR A:0x6b02302c
y.create.l HWIO_APCS_F1_QTMR_V1_CNTV_CVAL_LO_ADDR A:0x6b023030
y.create.l HWIO_APCS_F1_QTMR_V1_CNTV_CVAL_HI_ADDR A:0x6b023034
y.create.l HWIO_APCS_F1_QTMR_V1_CNTV_TVAL_ADDR A:0x6b023038
y.create.l HWIO_APCS_F1_QTMR_V1_CNTV_CTL_ADDR A:0x6b02303c
y.create.l HWIO_APCS_F1_QTMR_V1_VERSION_ADDR A:0x6b023fd0
y.create.l HWIO_APCS_F2_QTMR_V1_CNTPCT_LO_ADDR A:0x6b024000
y.create.l HWIO_APCS_F2_QTMR_V1_CNTPCT_HI_ADDR A:0x6b024004
y.create.l HWIO_APCS_F2_QTMR_V1_CNTVCT_LO_ADDR A:0x6b024008
y.create.l HWIO_APCS_F2_QTMR_V1_CNTVCT_HI_ADDR A:0x6b02400c
y.create.l HWIO_APCS_F2_QTMR_V1_CNTFRQ_ADDR A:0x6b024010
y.create.l HWIO_APCS_F2_QTMR_V1_CNTPL0ACR_ADDR A:0x6b024014
y.create.l HWIO_APCS_F2_QTMR_V1_CNTVOFF_LO_ADDR A:0x6b024018
y.create.l HWIO_APCS_F2_QTMR_V1_CNTVOFF_HI_ADDR A:0x6b02401c
y.create.l HWIO_APCS_F2_QTMR_V1_CNTP_CVAL_LO_ADDR A:0x6b024020
y.create.l HWIO_APCS_F2_QTMR_V1_CNTP_CVAL_HI_ADDR A:0x6b024024
y.create.l HWIO_APCS_F2_QTMR_V1_CNTP_TVAL_ADDR A:0x6b024028
y.create.l HWIO_APCS_F2_QTMR_V1_CNTP_CTL_ADDR A:0x6b02402c
y.create.l HWIO_APCS_F2_QTMR_V1_CNTV_CVAL_LO_ADDR A:0x6b024030
y.create.l HWIO_APCS_F2_QTMR_V1_CNTV_CVAL_HI_ADDR A:0x6b024034
y.create.l HWIO_APCS_F2_QTMR_V1_CNTV_TVAL_ADDR A:0x6b024038
y.create.l HWIO_APCS_F2_QTMR_V1_CNTV_CTL_ADDR A:0x6b02403c
y.create.l HWIO_APCS_F2_QTMR_V1_VERSION_ADDR A:0x6b024fd0
y.create.l HWIO_APCS_F3_QTMR_V1_CNTPCT_LO_ADDR A:0x6b025000
y.create.l HWIO_APCS_F3_QTMR_V1_CNTPCT_HI_ADDR A:0x6b025004
y.create.l HWIO_APCS_F3_QTMR_V1_CNTVCT_LO_ADDR A:0x6b025008
y.create.l HWIO_APCS_F3_QTMR_V1_CNTVCT_HI_ADDR A:0x6b02500c
y.create.l HWIO_APCS_F3_QTMR_V1_CNTFRQ_ADDR A:0x6b025010
y.create.l HWIO_APCS_F3_QTMR_V1_CNTPL0ACR_ADDR A:0x6b025014
y.create.l HWIO_APCS_F3_QTMR_V1_CNTVOFF_LO_ADDR A:0x6b025018
y.create.l HWIO_APCS_F3_QTMR_V1_CNTVOFF_HI_ADDR A:0x6b02501c
y.create.l HWIO_APCS_F3_QTMR_V1_CNTP_CVAL_LO_ADDR A:0x6b025020
y.create.l HWIO_APCS_F3_QTMR_V1_CNTP_CVAL_HI_ADDR A:0x6b025024
y.create.l HWIO_APCS_F3_QTMR_V1_CNTP_TVAL_ADDR A:0x6b025028
y.create.l HWIO_APCS_F3_QTMR_V1_CNTP_CTL_ADDR A:0x6b02502c
y.create.l HWIO_APCS_F3_QTMR_V1_CNTV_CVAL_LO_ADDR A:0x6b025030
y.create.l HWIO_APCS_F3_QTMR_V1_CNTV_CVAL_HI_ADDR A:0x6b025034
y.create.l HWIO_APCS_F3_QTMR_V1_CNTV_TVAL_ADDR A:0x6b025038
y.create.l HWIO_APCS_F3_QTMR_V1_CNTV_CTL_ADDR A:0x6b02503c
y.create.l HWIO_APCS_F3_QTMR_V1_VERSION_ADDR A:0x6b025fd0
y.create.l HWIO_APCS_F4_QTMR_V1_CNTPCT_LO_ADDR A:0x6b026000
y.create.l HWIO_APCS_F4_QTMR_V1_CNTPCT_HI_ADDR A:0x6b026004
y.create.l HWIO_APCS_F4_QTMR_V1_CNTVCT_LO_ADDR A:0x6b026008
y.create.l HWIO_APCS_F4_QTMR_V1_CNTVCT_HI_ADDR A:0x6b02600c
y.create.l HWIO_APCS_F4_QTMR_V1_CNTFRQ_ADDR A:0x6b026010
y.create.l HWIO_APCS_F4_QTMR_V1_CNTPL0ACR_ADDR A:0x6b026014
y.create.l HWIO_APCS_F4_QTMR_V1_CNTVOFF_LO_ADDR A:0x6b026018
y.create.l HWIO_APCS_F4_QTMR_V1_CNTVOFF_HI_ADDR A:0x6b02601c
y.create.l HWIO_APCS_F4_QTMR_V1_CNTP_CVAL_LO_ADDR A:0x6b026020
y.create.l HWIO_APCS_F4_QTMR_V1_CNTP_CVAL_HI_ADDR A:0x6b026024
y.create.l HWIO_APCS_F4_QTMR_V1_CNTP_TVAL_ADDR A:0x6b026028
y.create.l HWIO_APCS_F4_QTMR_V1_CNTP_CTL_ADDR A:0x6b02602c
y.create.l HWIO_APCS_F4_QTMR_V1_CNTV_CVAL_LO_ADDR A:0x6b026030
y.create.l HWIO_APCS_F4_QTMR_V1_CNTV_CVAL_HI_ADDR A:0x6b026034
y.create.l HWIO_APCS_F4_QTMR_V1_CNTV_TVAL_ADDR A:0x6b026038
y.create.l HWIO_APCS_F4_QTMR_V1_CNTV_CTL_ADDR A:0x6b02603c
y.create.l HWIO_APCS_F4_QTMR_V1_VERSION_ADDR A:0x6b026fd0
y.create.l HWIO_APCS_F5_QTMR_V1_CNTPCT_LO_ADDR A:0x6b027000
y.create.l HWIO_APCS_F5_QTMR_V1_CNTPCT_HI_ADDR A:0x6b027004
y.create.l HWIO_APCS_F5_QTMR_V1_CNTVCT_LO_ADDR A:0x6b027008
y.create.l HWIO_APCS_F5_QTMR_V1_CNTVCT_HI_ADDR A:0x6b02700c
y.create.l HWIO_APCS_F5_QTMR_V1_CNTFRQ_ADDR A:0x6b027010
y.create.l HWIO_APCS_F5_QTMR_V1_CNTPL0ACR_ADDR A:0x6b027014
y.create.l HWIO_APCS_F5_QTMR_V1_CNTVOFF_LO_ADDR A:0x6b027018
y.create.l HWIO_APCS_F5_QTMR_V1_CNTVOFF_HI_ADDR A:0x6b02701c
y.create.l HWIO_APCS_F5_QTMR_V1_CNTP_CVAL_LO_ADDR A:0x6b027020
y.create.l HWIO_APCS_F5_QTMR_V1_CNTP_CVAL_HI_ADDR A:0x6b027024
y.create.l HWIO_APCS_F5_QTMR_V1_CNTP_TVAL_ADDR A:0x6b027028
y.create.l HWIO_APCS_F5_QTMR_V1_CNTP_CTL_ADDR A:0x6b02702c
y.create.l HWIO_APCS_F5_QTMR_V1_CNTV_CVAL_LO_ADDR A:0x6b027030
y.create.l HWIO_APCS_F5_QTMR_V1_CNTV_CVAL_HI_ADDR A:0x6b027034
y.create.l HWIO_APCS_F5_QTMR_V1_CNTV_TVAL_ADDR A:0x6b027038
y.create.l HWIO_APCS_F5_QTMR_V1_CNTV_CTL_ADDR A:0x6b02703c
y.create.l HWIO_APCS_F5_QTMR_V1_VERSION_ADDR A:0x6b027fd0
y.create.l HWIO_APCS_F6_QTMR_V1_CNTPCT_LO_ADDR A:0x6b028000
y.create.l HWIO_APCS_F6_QTMR_V1_CNTPCT_HI_ADDR A:0x6b028004
y.create.l HWIO_APCS_F6_QTMR_V1_CNTVCT_LO_ADDR A:0x6b028008
y.create.l HWIO_APCS_F6_QTMR_V1_CNTVCT_HI_ADDR A:0x6b02800c
y.create.l HWIO_APCS_F6_QTMR_V1_CNTFRQ_ADDR A:0x6b028010
y.create.l HWIO_APCS_F6_QTMR_V1_CNTPL0ACR_ADDR A:0x6b028014
y.create.l HWIO_APCS_F6_QTMR_V1_CNTVOFF_LO_ADDR A:0x6b028018
y.create.l HWIO_APCS_F6_QTMR_V1_CNTVOFF_HI_ADDR A:0x6b02801c
y.create.l HWIO_APCS_F6_QTMR_V1_CNTP_CVAL_LO_ADDR A:0x6b028020
y.create.l HWIO_APCS_F6_QTMR_V1_CNTP_CVAL_HI_ADDR A:0x6b028024
y.create.l HWIO_APCS_F6_QTMR_V1_CNTP_TVAL_ADDR A:0x6b028028
y.create.l HWIO_APCS_F6_QTMR_V1_CNTP_CTL_ADDR A:0x6b02802c
y.create.l HWIO_APCS_F6_QTMR_V1_CNTV_CVAL_LO_ADDR A:0x6b028030
y.create.l HWIO_APCS_F6_QTMR_V1_CNTV_CVAL_HI_ADDR A:0x6b028034
y.create.l HWIO_APCS_F6_QTMR_V1_CNTV_TVAL_ADDR A:0x6b028038
y.create.l HWIO_APCS_F6_QTMR_V1_CNTV_CTL_ADDR A:0x6b02803c
y.create.l HWIO_APCS_F6_QTMR_V1_VERSION_ADDR A:0x6b028fd0
y.create.l HWIO_APCS_F7_QTMR_V1_CNTPCT_LO_ADDR A:0x6b029000
y.create.l HWIO_APCS_F7_QTMR_V1_CNTPCT_HI_ADDR A:0x6b029004
y.create.l HWIO_APCS_F7_QTMR_V1_CNTVCT_LO_ADDR A:0x6b029008
y.create.l HWIO_APCS_F7_QTMR_V1_CNTVCT_HI_ADDR A:0x6b02900c
y.create.l HWIO_APCS_F7_QTMR_V1_CNTFRQ_ADDR A:0x6b029010
y.create.l HWIO_APCS_F7_QTMR_V1_CNTPL0ACR_ADDR A:0x6b029014
y.create.l HWIO_APCS_F7_QTMR_V1_CNTVOFF_LO_ADDR A:0x6b029018
y.create.l HWIO_APCS_F7_QTMR_V1_CNTVOFF_HI_ADDR A:0x6b02901c
y.create.l HWIO_APCS_F7_QTMR_V1_CNTP_CVAL_LO_ADDR A:0x6b029020
y.create.l HWIO_APCS_F7_QTMR_V1_CNTP_CVAL_HI_ADDR A:0x6b029024
y.create.l HWIO_APCS_F7_QTMR_V1_CNTP_TVAL_ADDR A:0x6b029028
y.create.l HWIO_APCS_F7_QTMR_V1_CNTP_CTL_ADDR A:0x6b02902c
y.create.l HWIO_APCS_F7_QTMR_V1_CNTV_CVAL_LO_ADDR A:0x6b029030
y.create.l HWIO_APCS_F7_QTMR_V1_CNTV_CVAL_HI_ADDR A:0x6b029034
y.create.l HWIO_APCS_F7_QTMR_V1_CNTV_TVAL_ADDR A:0x6b029038
y.create.l HWIO_APCS_F7_QTMR_V1_CNTV_CTL_ADDR A:0x6b02903c
y.create.l HWIO_APCS_F7_QTMR_V1_VERSION_ADDR A:0x6b029fd0
y.create.l HWIO_WDOG_SECURE_ADDR A:0x6b017000
y.create.l HWIO_WDOG_RESET_ADDR A:0x6b017004
y.create.l HWIO_WDOG_CTL_ADDR A:0x6b017008
y.create.l HWIO_WDOG_STATUS_ADDR A:0x6b01700c
y.create.l HWIO_WDOG_BARK_TIME_ADDR A:0x6b017010
y.create.l HWIO_WDOG_BITE_TIME_ADDR A:0x6b017014
y.create.l HWIO_WDOG_TEST_LOAD_STATUS_ADDR A:0x6b017018
y.create.l HWIO_WDOG_TEST_LOAD_ADDR A:0x6b01701c
y.create.l HWIO_WDOG_TEST_ADDR A:0x6b017020
y.create.l HWIO_APCS_GLBSECURE_ADDR A:0x6b010000
y.create.l HWIO_APCS_START_ADDR_ADDR A:0x6b010004
y.create.l HWIO_APCS_CMD_RCGR_ADDR A:0x6b010008
y.create.l HWIO_APCS_CFG_RCGR_ADDR A:0x6b01000c
y.create.l HWIO_APCS_CBCR_ADDR A:0x6b010010
y.create.l HWIO_APCS_GLB_CFG_ADDR A:0x6b010014
y.create.l HWIO_APCS_GLB_BOOT_REMAP_ADDR A:0x6b010018
y.create.l HWIO_APCS_GLB_TEST_BUSSEL_ADDR A:0x6b01001c
y.create.l HWIO_APCS_GLB_EN_PWR_ST_ADDR A:0x6b010020
y.create.l HWIO_APCS_GLB_QSB_LP_ADDR A:0x6b010024
y.create.l HWIO_APCS_GLB_AHB_CLKON_ADDR A:0x6b010028
y.create.l HWIO_APCS_GLB_QGIC_CFG_ADDR A:0x6b01002c
y.create.l HWIO_APCS_GLB_GHDS_CNTR_ADDR A:0x6b010030
y.create.l HWIO_APCS_TCM_REDIRECT_ADDR_ADDR A:0x6b010034
y.create.l HWIO_APCS_A7_GLB_CFG_ADDR A:0x6b010038
y.create.l HWIO_SPM_VOTE_TZ_ADDR A:0x6b01003c
y.create.l HWIO_SPM_VOTE_HLOS_ADDR A:0x6b010040
y.create.l HWIO_SPM_VOTE_HYP_ADDR A:0x6b010044
y.create.l HWIO_SPM_VOTE_INT_STS_ADDR A:0x6b010048
y.create.l HWIO_SPM_VOTE_INT_CLR_ADDR A:0x6b01004c
y.create.l HWIO_APPS_BOOTFSM_CTL_ADDR A:0x6b010050
y.create.l HWIO_APPS_BOOTFSM_STATUS_ADDR A:0x6b010054
y.create.l HWIO_APCS_GCCSECURE_ADDR A:0x6b011000
y.create.l HWIO_APCS_IPC_SECURITY_ADDR A:0x6b011004
y.create.l HWIO_APCS_IPC_ADDR A:0x6b011008
y.create.l HWIO_APCS_PWR_CTL_OVERRIDE_ADDR A:0x6b01100c
y.create.l HWIO_APCS_GCLK_STS_ADDR A:0x6b011010
y.create.l HWIO_APCS_L2_PWR_CTL_ADDR A:0x6b011014
y.create.l HWIO_APCS_PWR_STS_ADDR A:0x6b011018
y.create.l HWIO_APCS_CLK_DIAG_ADDR A:0x6b01101c
y.create.l HWIO_APCS_ALL_TSTBUS_SEL_ADDR A:0x6b011020
y.create.l HWIO_APCS_DBG_PWR_CTL_ADDR A:0x6b011024
y.create.l HWIO_APCS_L2_AUX_CLK_SEL_ADDR A:0x6b011028
y.create.l HWIO_APCS_SPARE_ADDR A:0x6b01102c
y.create.l HWIO_APCS_SPARE_STS_ADDR A:0x6b011030
y.create.l HWIO_XPU_STATUS_ADDR A:0x6b011034
y.create.l HWIO_APCS_HW_EVENT_SEL_0_ADDR A:0x6b011038
y.create.l HWIO_APCS_HW_EVENT_SEL_1_ADDR A:0x6b01103c
y.create.l HWIO_APCS_HW_EVENT_SEL_2_ADDR A:0x6b011040
y.create.l HWIO_APCS_HW_EVENT_SEL_3_ADDR A:0x6b011044
y.create.l HWIO_APCS_HW_EVENT_SEL_4_ADDR A:0x6b011048
y.create.l HWIO_APCS_HW_EVENT_SEL_5_ADDR A:0x6b01104c
y.create.l HWIO_APCS_HW_EVENT_SEL_6_ADDR A:0x6b011050
y.create.l HWIO_APCS_HW_EVENT_SEL_7_ADDR A:0x6b011054
y.create.l HWIO_APCS_HW_EVENT_SEL_8_ADDR A:0x6b011058
y.create.l HWIO_APCS_HW_EVENT_SEL_9_ADDR A:0x6b01105c
y.create.l HWIO_BIMC_HW_VERSION_ADDR A:0x60400000
y.create.l HWIO_BIMC_CORE_INFO_ADDR A:0x60400004
y.create.l HWIO_BIMC_HW_INFO_ADDR A:0x60400008
y.create.l HWIO_BIMC_CORE_CLK_SEL_ADDR A:0x60400020
y.create.l HWIO_BIMC_CORE_CLK_PERIOD_ADDR A:0x60400024
y.create.l HWIO_BIMC_SCMO0_LOCAL_CGC_THRESHOLD_ADDR A:0x60400100
y.create.l HWIO_BIMC_DPE0_LOCAL_CGC_THRESHOLD_ADDR A:0x60400140
y.create.l HWIO_BIMC_MPORT_CORE_DOMAIN_LOCAL_CGC_THRESHOLD_ADDR A:0x60400180
y.create.l HWIO_BIMC_MPORT0_CLK_LOCAL_CGC_THRESHOLD_ADDR A:0x604001c0
y.create.l HWIO_BIMC_MPORT1_CLK_LOCAL_CGC_THRESHOLD_ADDR A:0x604001c4
y.create.l HWIO_BIMC_MPORT2_CLK_LOCAL_CGC_THRESHOLD_ADDR A:0x604001c8
y.create.l HWIO_BIMC_MPORT3_CLK_LOCAL_CGC_THRESHOLD_ADDR A:0x604001cc
y.create.l HWIO_BIMC_MPORT4_CLK_LOCAL_CGC_THRESHOLD_ADDR A:0x604001d0
y.create.l HWIO_BIMC_SWAY_LOCAL_CGC_THRESHOLD_ADDR A:0x60400200
y.create.l HWIO_BIMC_SCMO0_CGC_CFG_ADDR A:0x60400240
y.create.l HWIO_BIMC_DPE0_CGC_CFG_ADDR A:0x60400280
y.create.l HWIO_BIMC_CALIBRATION_CFG_ADDR A:0x60400400
y.create.l HWIO_BIMC_DFI0_LP_CFG_ADDR A:0x60400600
y.create.l HWIO_BIMC_HFSC_CFG_ADDR A:0x60400800
y.create.l HWIO_BIMC_HFSC_STATUS_ADDR A:0x6040080c
y.create.l HWIO_BIMC_HFSC_STAGE1_CTRL_ADDR A:0x60400840
y.create.l HWIO_BIMC_HFSC_STAGE2_CTRL_ADDR A:0x60400860
y.create.l HWIO_BIMC_BRIC_GLOBAL1_COMPONENT_INFO_ADDR A:0x60401000
y.create.l HWIO_BIMC_BRIC_HW_INFO_ADDR A:0x60401010
y.create.l HWIO_BIMC_BRIC_HW_VERSION_ADDR A:0x60401014
y.create.l HWIO_BIMC_BRIC_CONFIGURATION_INFO_0_ADDR A:0x60401020
y.create.l HWIO_BIMC_BRIC_CONFIGURATION_INFO_1_ADDR A:0x60401030
y.create.l HWIO_BIMC_BRIC_CONFIGURATION_INFO_2A_ADDR A:0x60401040
y.create.l HWIO_BIMC_BRIC_CONFIGURATION_INFO_2B_ADDR A:0x60401044
y.create.l HWIO_BIMC_BRIC_CONFIGURATION_INFO_2C_ADDR A:0x60401048
y.create.l HWIO_BIMC_BRIC_CONFIGURATION_INFO_2D_ADDR A:0x6040104c
y.create.l HWIO_BIMC_BRIC_INTERRUPT_STATUS_0_ADDR A:0x60401100
y.create.l HWIO_BIMC_BRIC_INTERRUPT_CLEAR_0_ADDR A:0x60401108
y.create.l HWIO_BIMC_BRIC_INTERRUPT_ENABLE_0_ADDR A:0x6040110c
y.create.l HWIO_BIMC_BRIC_INTERRUPT_STATUS_1_ADDR A:0x60401110
y.create.l HWIO_BIMC_BRIC_INTERRUPT_CLEAR_1_ADDR A:0x60401118
y.create.l HWIO_BIMC_BRIC_INTERRUPT_ENABLE_1_ADDR A:0x6040111c
y.create.l HWIO_BIMC_BRIC_INTERRUPT_STATUS_2_ADDR A:0x60401120
y.create.l HWIO_BIMC_BRIC_INTERRUPT_CLEAR_2_ADDR A:0x60401128
y.create.l HWIO_BIMC_BRIC_INTERRUPT_ENABLE_2_ADDR A:0x6040112c
y.create.l HWIO_BIMC_BRIC_INTERRUPT_STATUS_3_ADDR A:0x60401130
y.create.l HWIO_BIMC_BRIC_INTERRUPT_CLEAR_3_ADDR A:0x60401138
y.create.l HWIO_BIMC_BRIC_INTERRUPT_ENABLE_3_ADDR A:0x6040113c
y.create.l HWIO_BIMC_BRIC_REF_TIMER_INTERVAL_ADDR A:0x60401200
y.create.l HWIO_BIMC_BRIC_DEBUG_SELECT_ADDR A:0x60401210
y.create.l HWIO_BIMC_BRIC_MSA_LOCKS_ADDR A:0x60401300
y.create.l HWIO_BIMC_BRIC_PROTNS_LOCKS_ADDR A:0x60401310
y.create.l HWIO_BIMC_BRIC_GLOBAL2_COMPONENT_INFO_ADDR A:0x60402000
y.create.l HWIO_BIMC_BRIC_DEFAULT_SEGMENT_ADDR A:0x604021f0
y.create.l HWIO_BIMC_BRIC_SEGMENT0_ADDR_BASE_A_LOWER_ADDR A:0x60402200
y.create.l HWIO_BIMC_BRIC_SEGMENT1_ADDR_BASE_A_LOWER_ADDR A:0x60402280
y.create.l HWIO_BIMC_BRIC_SEGMENT2_ADDR_BASE_A_LOWER_ADDR A:0x60402300
y.create.l HWIO_BIMC_BRIC_SEGMENT0_ADDR_BASE_A_UPPER_ADDR A:0x60402204
y.create.l HWIO_BIMC_BRIC_SEGMENT1_ADDR_BASE_A_UPPER_ADDR A:0x60402284
y.create.l HWIO_BIMC_BRIC_SEGMENT2_ADDR_BASE_A_UPPER_ADDR A:0x60402304
y.create.l HWIO_BIMC_BRIC_SEGMENT0_ADDR_MASK_A_LOWER_ADDR A:0x60402208
y.create.l HWIO_BIMC_BRIC_SEGMENT1_ADDR_MASK_A_LOWER_ADDR A:0x60402288
y.create.l HWIO_BIMC_BRIC_SEGMENT2_ADDR_MASK_A_LOWER_ADDR A:0x60402308
y.create.l HWIO_BIMC_BRIC_SEGMENT0_ADDR_MASK_A_UPPER_ADDR A:0x6040220c
y.create.l HWIO_BIMC_BRIC_SEGMENT1_ADDR_MASK_A_UPPER_ADDR A:0x6040228c
y.create.l HWIO_BIMC_BRIC_SEGMENT2_ADDR_MASK_A_UPPER_ADDR A:0x6040230c
y.create.l HWIO_BIMC_BRIC_SEGMENT0_ADDR_BASE_B_LOWER_ADDR A:0x60402210
y.create.l HWIO_BIMC_BRIC_SEGMENT1_ADDR_BASE_B_LOWER_ADDR A:0x60402290
y.create.l HWIO_BIMC_BRIC_SEGMENT2_ADDR_BASE_B_LOWER_ADDR A:0x60402310
y.create.l HWIO_BIMC_BRIC_SEGMENT0_ADDR_BASE_B_UPPER_ADDR A:0x60402214
y.create.l HWIO_BIMC_BRIC_SEGMENT1_ADDR_BASE_B_UPPER_ADDR A:0x60402294
y.create.l HWIO_BIMC_BRIC_SEGMENT2_ADDR_BASE_B_UPPER_ADDR A:0x60402314
y.create.l HWIO_BIMC_BRIC_SEGMENT0_ADDR_MASK_B_LOWER_ADDR A:0x60402218
y.create.l HWIO_BIMC_BRIC_SEGMENT1_ADDR_MASK_B_LOWER_ADDR A:0x60402298
y.create.l HWIO_BIMC_BRIC_SEGMENT2_ADDR_MASK_B_LOWER_ADDR A:0x60402318
y.create.l HWIO_BIMC_BRIC_SEGMENT0_ADDR_MASK_B_UPPER_ADDR A:0x6040221c
y.create.l HWIO_BIMC_BRIC_SEGMENT1_ADDR_MASK_B_UPPER_ADDR A:0x6040229c
y.create.l HWIO_BIMC_BRIC_SEGMENT2_ADDR_MASK_B_UPPER_ADDR A:0x6040231c
y.create.l HWIO_BIMC_BRIC_SEGMENT0_ADDR_BASE_C_LOWER_ADDR A:0x60402220
y.create.l HWIO_BIMC_BRIC_SEGMENT1_ADDR_BASE_C_LOWER_ADDR A:0x604022a0
y.create.l HWIO_BIMC_BRIC_SEGMENT2_ADDR_BASE_C_LOWER_ADDR A:0x60402320
y.create.l HWIO_BIMC_BRIC_SEGMENT0_ADDR_BASE_C_UPPER_ADDR A:0x60402224
y.create.l HWIO_BIMC_BRIC_SEGMENT1_ADDR_BASE_C_UPPER_ADDR A:0x604022a4
y.create.l HWIO_BIMC_BRIC_SEGMENT2_ADDR_BASE_C_UPPER_ADDR A:0x60402324
y.create.l HWIO_BIMC_BRIC_SEGMENT0_ADDR_MASK_C_LOWER_ADDR A:0x60402228
y.create.l HWIO_BIMC_BRIC_SEGMENT1_ADDR_MASK_C_LOWER_ADDR A:0x604022a8
y.create.l HWIO_BIMC_BRIC_SEGMENT2_ADDR_MASK_C_LOWER_ADDR A:0x60402328
y.create.l HWIO_BIMC_BRIC_SEGMENT0_ADDR_MASK_C_UPPER_ADDR A:0x6040222c
y.create.l HWIO_BIMC_BRIC_SEGMENT1_ADDR_MASK_C_UPPER_ADDR A:0x604022ac
y.create.l HWIO_BIMC_BRIC_SEGMENT2_ADDR_MASK_C_UPPER_ADDR A:0x6040232c
y.create.l HWIO_BIMC_BRIC_REMAP0_ADDR_BASE_LOWER_ADDR A:0x60402a00
y.create.l HWIO_BIMC_BRIC_REMAP1_ADDR_BASE_LOWER_ADDR A:0x60402a40
y.create.l HWIO_BIMC_BRIC_REMAP2_ADDR_BASE_LOWER_ADDR A:0x60402a80
y.create.l HWIO_BIMC_BRIC_REMAP3_ADDR_BASE_LOWER_ADDR A:0x60402ac0
y.create.l HWIO_BIMC_BRIC_REMAP0_ADDR_BASE_UPPER_ADDR A:0x60402a04
y.create.l HWIO_BIMC_BRIC_REMAP1_ADDR_BASE_UPPER_ADDR A:0x60402a44
y.create.l HWIO_BIMC_BRIC_REMAP2_ADDR_BASE_UPPER_ADDR A:0x60402a84
y.create.l HWIO_BIMC_BRIC_REMAP3_ADDR_BASE_UPPER_ADDR A:0x60402ac4
y.create.l HWIO_BIMC_BRIC_REMAP0_ADDR_MASK_LOWER_ADDR A:0x60402a08
y.create.l HWIO_BIMC_BRIC_REMAP1_ADDR_MASK_LOWER_ADDR A:0x60402a48
y.create.l HWIO_BIMC_BRIC_REMAP2_ADDR_MASK_LOWER_ADDR A:0x60402a88
y.create.l HWIO_BIMC_BRIC_REMAP3_ADDR_MASK_LOWER_ADDR A:0x60402ac8
y.create.l HWIO_BIMC_BRIC_REMAP0_ADDR_MASK_UPPER_ADDR A:0x60402a0c
y.create.l HWIO_BIMC_BRIC_REMAP1_ADDR_MASK_UPPER_ADDR A:0x60402a4c
y.create.l HWIO_BIMC_BRIC_REMAP2_ADDR_MASK_UPPER_ADDR A:0x60402a8c
y.create.l HWIO_BIMC_BRIC_REMAP3_ADDR_MASK_UPPER_ADDR A:0x60402acc
y.create.l HWIO_BIMC_BRIC_REMAP0_OP0_ADDR A:0x60402a20
y.create.l HWIO_BIMC_BRIC_REMAP1_OP0_ADDR A:0x60402a60
y.create.l HWIO_BIMC_BRIC_REMAP2_OP0_ADDR A:0x60402aa0
y.create.l HWIO_BIMC_BRIC_REMAP3_OP0_ADDR A:0x60402ae0
y.create.l HWIO_BIMC_BRIC_REMAP0_OP1_ADDR A:0x60402a24
y.create.l HWIO_BIMC_BRIC_REMAP1_OP1_ADDR A:0x60402a64
y.create.l HWIO_BIMC_BRIC_REMAP2_OP1_ADDR A:0x60402aa4
y.create.l HWIO_BIMC_BRIC_REMAP3_OP1_ADDR A:0x60402ae4
y.create.l HWIO_BIMC_PERFMON_COMPONENT_INFO_ADDR A:0x60403000
y.create.l HWIO_BIMC_PERFMON_CONFIGURATION_INFO_ADDR A:0x60403020
y.create.l HWIO_BIMC_PERFMON_CLOCK_CTRL_ADDR A:0x60403200
y.create.l HWIO_BIMC_PERFMON_MODE_ADDR A:0x60403210
y.create.l HWIO_BIMC_PERFMON_DUMP_ADDR A:0x60403214
y.create.l HWIO_BIMC_PERFMON_TIMED_MODE_INTERVAL_ADDR A:0x60403220
y.create.l HWIO_BIMC_PERFMON_TIMED_MODE_ITERATIONS_ADDR A:0x60403230
y.create.l HWIO_BIMC_PERFMON_STATUS_ADDR A:0x604032f0
y.create.l HWIO_BIMC_PERFMON_COUNTER_0_CONFIG_ADDR A:0x60403300
y.create.l HWIO_BIMC_PERFMON_COUNTER_1_CONFIG_ADDR A:0x60403310
y.create.l HWIO_BIMC_PERFMON_COUNTER_2_CONFIG_ADDR A:0x60403320
y.create.l HWIO_BIMC_PERFMON_COUNTER_3_CONFIG_ADDR A:0x60403330
y.create.l HWIO_BIMC_PERFMON_COUNTER_4_CONFIG_ADDR A:0x60403340
y.create.l HWIO_BIMC_PERFMON_COUNTER_5_CONFIG_ADDR A:0x60403350
y.create.l HWIO_BIMC_PERFMON_COUNTER_6_CONFIG_ADDR A:0x60403360
y.create.l HWIO_BIMC_PERFMON_COUNTER_7_CONFIG_ADDR A:0x60403370
y.create.l HWIO_BIMC_PERFMON_COUNTER_8_CONFIG_ADDR A:0x60403380
y.create.l HWIO_BIMC_PERFMON_COUNTER_9_CONFIG_ADDR A:0x60403390
y.create.l HWIO_BIMC_PERFMON_COUNTER_0_ADDR A:0x60403308
y.create.l HWIO_BIMC_PERFMON_COUNTER_1_ADDR A:0x60403318
y.create.l HWIO_BIMC_PERFMON_COUNTER_2_ADDR A:0x60403328
y.create.l HWIO_BIMC_PERFMON_COUNTER_3_ADDR A:0x60403338
y.create.l HWIO_BIMC_PERFMON_COUNTER_4_ADDR A:0x60403348
y.create.l HWIO_BIMC_PERFMON_COUNTER_5_ADDR A:0x60403358
y.create.l HWIO_BIMC_PERFMON_COUNTER_6_ADDR A:0x60403368
y.create.l HWIO_BIMC_PERFMON_COUNTER_7_ADDR A:0x60403378
y.create.l HWIO_BIMC_PERFMON_COUNTER_8_ADDR A:0x60403388
y.create.l HWIO_BIMC_PERFMON_COUNTER_9_ADDR A:0x60403398
y.create.l HWIO_BIMC_PERFMON_COUNTER_0_OVERFLOW_ADDR A:0x6040330c
y.create.l HWIO_BIMC_PERFMON_COUNTER_1_OVERFLOW_ADDR A:0x6040331c
y.create.l HWIO_BIMC_PERFMON_COUNTER_2_OVERFLOW_ADDR A:0x6040332c
y.create.l HWIO_BIMC_PERFMON_COUNTER_3_OVERFLOW_ADDR A:0x6040333c
y.create.l HWIO_BIMC_PERFMON_COUNTER_4_OVERFLOW_ADDR A:0x6040334c
y.create.l HWIO_BIMC_PERFMON_COUNTER_5_OVERFLOW_ADDR A:0x6040335c
y.create.l HWIO_BIMC_PERFMON_COUNTER_6_OVERFLOW_ADDR A:0x6040336c
y.create.l HWIO_BIMC_PERFMON_COUNTER_7_OVERFLOW_ADDR A:0x6040337c
y.create.l HWIO_BIMC_PERFMON_COUNTER_8_OVERFLOW_ADDR A:0x6040338c
y.create.l HWIO_BIMC_PERFMON_COUNTER_9_OVERFLOW_ADDR A:0x6040339c
y.create.l HWIO_BIMC_DTE_HW_INFO_ADDR A:0x60406000
y.create.l HWIO_BIMC_DTE_GLOBAL_CNTL_ADDR A:0x60406004
y.create.l HWIO_BIMC_DTE_PROGRAM_CNTL_ADDR A:0x6040600c
y.create.l HWIO_BIMC_DTE_REG_CNTL_ADDR A:0x60406010
y.create.l HWIO_BIMC_DTE_REG_DATA_ADDR A:0x60406014
y.create.l HWIO_BIMC_DTE_TEST_STATUS_DDR_ADDR A:0x60406020
y.create.l HWIO_BIMC_DTE_TEST_STATUS_QSB_ADDR A:0x60406024
y.create.l HWIO_BIMC_DTE_TEST_MEM_CNTL_ADDR A:0x60406030
y.create.l HWIO_BIMC_DTE_TEST_MEM_DATA_0_ADDR A:0x60406038
y.create.l HWIO_BIMC_DTE_TEST_MEM_DATA_1_ADDR A:0x6040603c
y.create.l HWIO_BIMC_M_APP_MPORT_COMPONENT_INFO_ADDR A:0x60408000
y.create.l HWIO_BIMC_M_APP_MPORT_CONFIGURATION_INFO_0_ADDR A:0x60408020
y.create.l HWIO_BIMC_M_APP_MPORT_CONFIGURATION_INFO_1_ADDR A:0x60408030
y.create.l HWIO_BIMC_M_APP_MPORT_CONFIGURATION_INFO_2A_ADDR A:0x60408040
y.create.l HWIO_BIMC_M_APP_MPORT_CONFIGURATION_INFO_2B_ADDR A:0x60408044
y.create.l HWIO_BIMC_M_APP_MPORT_CONFIGURATION_INFO_3_ADDR A:0x60408050
y.create.l HWIO_BIMC_M_APP_MPORT_CONFIGURATION_INFO_4_ADDR A:0x60408060
y.create.l HWIO_BIMC_M_APP_MPORT_CONFIGURATION_INFO_5A_ADDR A:0x60408070
y.create.l HWIO_BIMC_M_APP_MPORT_CONFIGURATION_INFO_5B_ADDR A:0x60408074
y.create.l HWIO_BIMC_M_APP_MPORT_CONFIGURATION_INFO_5C_ADDR A:0x60408078
y.create.l HWIO_BIMC_M_APP_MPORT_CONFIGURATION_INFO_5D_ADDR A:0x6040807c
y.create.l HWIO_BIMC_M_APP_MPORT_INTERRUPT_STATUS_ADDR A:0x60408100
y.create.l HWIO_BIMC_M_APP_MPORT_INTERRUPT_CLEAR_ADDR A:0x60408108
y.create.l HWIO_BIMC_M_APP_MPORT_INTERRUPT_ENABLE_ADDR A:0x6040810c
y.create.l HWIO_BIMC_M_APP_MPORT_CLOCK_CTRL_ADDR A:0x60408200
y.create.l HWIO_BIMC_M_APP_MPORT_CDC_CTRL_ADDR A:0x60408208
y.create.l HWIO_BIMC_M_APP_MPORT_MODE_ADDR A:0x60408210
y.create.l HWIO_BIMC_M_APP_MPORT_WR_WAY_CROSSING_ADDR A:0x60408220
y.create.l HWIO_BIMC_M_APP_MPORT_PRIORITYLVL_OVERRIDE_ADDR A:0x60408230
y.create.l HWIO_BIMC_M_APP_MPORT_READ_COMMAND_OVERRIDE_ADDR A:0x60408240
y.create.l HWIO_BIMC_M_APP_MPORT_WRITE_COMMAND_OVERRIDE_ADDR A:0x60408250
y.create.l HWIO_BIMC_M_APP_MPORT_RD_TRACKING_INDEX_ADDR A:0x60408270
y.create.l HWIO_BIMC_M_APP_MPORT_WR_TRACKING_INDEX_ADDR A:0x60408274
y.create.l HWIO_BIMC_M_APP_MPORT_BKE_ENABLE_ADDR A:0x60408300
y.create.l HWIO_BIMC_M_APP_MPORT_BKE_GRANT_PERIOD_ADDR A:0x60408304
y.create.l HWIO_BIMC_M_APP_MPORT_BKE_GRANT_COUNT_ADDR A:0x60408308
y.create.l HWIO_BIMC_M_APP_MPORT_BKE_THRESHOLD_HIGH_ADDR A:0x60408320
y.create.l HWIO_BIMC_M_APP_MPORT_BKE_THRESHOLD_MEDIUM_ADDR A:0x60408324
y.create.l HWIO_BIMC_M_APP_MPORT_BKE_THRESHOLD_LOW_ADDR A:0x60408328
y.create.l HWIO_BIMC_M_APP_MPORT_BKE_HEALTH_0_ADDR A:0x60408340
y.create.l HWIO_BIMC_M_APP_MPORT_BKE_HEALTH_1_ADDR A:0x60408344
y.create.l HWIO_BIMC_M_APP_MPORT_BKE_HEALTH_2_ADDR A:0x60408348
y.create.l HWIO_BIMC_M_APP_MPORT_BKE_HEALTH_3_ADDR A:0x6040834c
y.create.l HWIO_BIMC_M_APP_MPORT_STATUS_2A_ADDR A:0x60408420
y.create.l HWIO_BIMC_M_APP_MPORT_STATUS_2B_ADDR A:0x60408424
y.create.l HWIO_BIMC_M_APP_MPORT_STATUS_3A_ADDR A:0x60408430
y.create.l HWIO_BIMC_M_APP_MPORT_STATUS_3B_ADDR A:0x60408434
y.create.l HWIO_BIMC_M_APP_PROF_COMPONENT_INFO_ADDR A:0x60409000
y.create.l HWIO_BIMC_M_APP_PROF_CONFIGURATION_INFO_0_ADDR A:0x60409020
y.create.l HWIO_BIMC_M_APP_PROF_CONFIGURATION_INFO_1_ADDR A:0x60409030
y.create.l HWIO_BIMC_M_APP_PROF_CLOCK_CTRL_ADDR A:0x60409200
y.create.l HWIO_BIMC_M_APP_PROF_MODE_ADDR A:0x60409210
y.create.l HWIO_BIMC_M_APP_PROF_RD_TENURE_THRESHOLD_ADDR A:0x60409214
y.create.l HWIO_BIMC_M_APP_PROF_WR_TENURE_THRESHOLD_ADDR A:0x60409218
y.create.l HWIO_BIMC_M_APP_PROF_SWAY_SELECT_ADDR A:0x60409220
y.create.l HWIO_BIMC_M_APP_PROF_MID_MASK_ADDR A:0x60409230
y.create.l HWIO_BIMC_M_APP_PROF_MID_MATCH_ADDR A:0x60409234
y.create.l HWIO_BIMC_M_APP_PROF_MID_INV_MATCH_ADDR A:0x60409238
y.create.l HWIO_BIMC_M_APP_PROF_ADDR_MASK_LOWER_ADDR A:0x60409240
y.create.l HWIO_BIMC_M_APP_PROF_ADDR_MASK_UPPER_ADDR A:0x60409244
y.create.l HWIO_BIMC_M_APP_PROF_ADDR_MATCH_LOWER_ADDR A:0x60409248
y.create.l HWIO_BIMC_M_APP_PROF_ADDR_MATCH_UPPER_ADDR A:0x6040924c
y.create.l HWIO_BIMC_M_APP_PROF_ADDR_INV_MATCH_ADDR A:0x60409250
y.create.l HWIO_BIMC_M_APP_PROF_ACH_MASK_0_ADDR A:0x60409260
y.create.l HWIO_BIMC_M_APP_PROF_ACH_MATCH_0_ADDR A:0x60409264
y.create.l HWIO_BIMC_M_APP_PROF_ACH_MASK_1_ADDR A:0x60409270
y.create.l HWIO_BIMC_M_APP_PROF_ACH_MATCH_1_ADDR A:0x60409274
y.create.l HWIO_BIMC_M_APP_PROF_ACH_INV_MATCH_1_ADDR A:0x60409278
y.create.l HWIO_BIMC_M_APP_PROF_ACH_MASK_2_ADDR A:0x60409280
y.create.l HWIO_BIMC_M_APP_PROF_ACH_MATCH_2_ADDR A:0x60409284
y.create.l HWIO_BIMC_M_APP_PROF_ACH_MASK_3_ADDR A:0x60409290
y.create.l HWIO_BIMC_M_APP_PROF_ACH_MATCH_3_ADDR A:0x60409294
y.create.l HWIO_BIMC_M_APP_PROF_ACH_INV_MATCH_3_ADDR A:0x60409298
y.create.l HWIO_BIMC_M_APP_PROF_ACH_MASK_4_ADDR A:0x604092a0
y.create.l HWIO_BIMC_M_APP_PROF_ACH_MATCH_4_ADDR A:0x604092a4
y.create.l HWIO_BIMC_M_APP_PROF_ACH_INV_MATCH_4_ADDR A:0x604092a8
y.create.l HWIO_BIMC_M_APP_PROF_BCH_MASK_ADDR A:0x60409300
y.create.l HWIO_BIMC_M_APP_PROF_BCH_MATCH_ADDR A:0x60409304
y.create.l HWIO_BIMC_M_APP_PROF_BCH_INV_MATCH_ADDR A:0x60409308
y.create.l HWIO_BIMC_M_APP_PROF_RCH_MASK_ADDR A:0x60409340
y.create.l HWIO_BIMC_M_APP_PROF_RCH_MATCH_ADDR A:0x60409344
y.create.l HWIO_BIMC_M_APP_PROF_RCH_INV_MATCH_ADDR A:0x60409348
y.create.l HWIO_BIMC_M_APP_PROF_RD_STATUS_0_ADDR A:0x60409400
y.create.l HWIO_BIMC_M_APP_PROF_WR_STATUS_0_ADDR A:0x60409410
y.create.l HWIO_BIMC_M_DSP_MPORT_COMPONENT_INFO_ADDR A:0x6040c000
y.create.l HWIO_BIMC_M_DSP_MPORT_CONFIGURATION_INFO_0_ADDR A:0x6040c020
y.create.l HWIO_BIMC_M_DSP_MPORT_CONFIGURATION_INFO_1_ADDR A:0x6040c030
y.create.l HWIO_BIMC_M_DSP_MPORT_CONFIGURATION_INFO_2A_ADDR A:0x6040c040
y.create.l HWIO_BIMC_M_DSP_MPORT_CONFIGURATION_INFO_2B_ADDR A:0x6040c044
y.create.l HWIO_BIMC_M_DSP_MPORT_CONFIGURATION_INFO_3_ADDR A:0x6040c050
y.create.l HWIO_BIMC_M_DSP_MPORT_CONFIGURATION_INFO_4_ADDR A:0x6040c060
y.create.l HWIO_BIMC_M_DSP_MPORT_CONFIGURATION_INFO_5A_ADDR A:0x6040c070
y.create.l HWIO_BIMC_M_DSP_MPORT_CONFIGURATION_INFO_5B_ADDR A:0x6040c074
y.create.l HWIO_BIMC_M_DSP_MPORT_CONFIGURATION_INFO_5C_ADDR A:0x6040c078
y.create.l HWIO_BIMC_M_DSP_MPORT_CONFIGURATION_INFO_5D_ADDR A:0x6040c07c
y.create.l HWIO_BIMC_M_DSP_MPORT_INTERRUPT_STATUS_ADDR A:0x6040c100
y.create.l HWIO_BIMC_M_DSP_MPORT_INTERRUPT_CLEAR_ADDR A:0x6040c108
y.create.l HWIO_BIMC_M_DSP_MPORT_INTERRUPT_ENABLE_ADDR A:0x6040c10c
y.create.l HWIO_BIMC_M_DSP_MPORT_CLOCK_CTRL_ADDR A:0x6040c200
y.create.l HWIO_BIMC_M_DSP_MPORT_CDC_CTRL_ADDR A:0x6040c208
y.create.l HWIO_BIMC_M_DSP_MPORT_MODE_ADDR A:0x6040c210
y.create.l HWIO_BIMC_M_DSP_MPORT_WR_WAY_CROSSING_ADDR A:0x6040c220
y.create.l HWIO_BIMC_M_DSP_MPORT_PRIORITYLVL_OVERRIDE_ADDR A:0x6040c230
y.create.l HWIO_BIMC_M_DSP_MPORT_READ_COMMAND_OVERRIDE_ADDR A:0x6040c240
y.create.l HWIO_BIMC_M_DSP_MPORT_WRITE_COMMAND_OVERRIDE_ADDR A:0x6040c250
y.create.l HWIO_BIMC_M_DSP_MPORT_RD_TRACKING_INDEX_ADDR A:0x6040c270
y.create.l HWIO_BIMC_M_DSP_MPORT_WR_TRACKING_INDEX_ADDR A:0x6040c274
y.create.l HWIO_BIMC_M_DSP_MPORT_BKE_ENABLE_ADDR A:0x6040c300
y.create.l HWIO_BIMC_M_DSP_MPORT_BKE_GRANT_PERIOD_ADDR A:0x6040c304
y.create.l HWIO_BIMC_M_DSP_MPORT_BKE_GRANT_COUNT_ADDR A:0x6040c308
y.create.l HWIO_BIMC_M_DSP_MPORT_BKE_THRESHOLD_HIGH_ADDR A:0x6040c320
y.create.l HWIO_BIMC_M_DSP_MPORT_BKE_THRESHOLD_MEDIUM_ADDR A:0x6040c324
y.create.l HWIO_BIMC_M_DSP_MPORT_BKE_THRESHOLD_LOW_ADDR A:0x6040c328
y.create.l HWIO_BIMC_M_DSP_MPORT_BKE_HEALTH_0_ADDR A:0x6040c340
y.create.l HWIO_BIMC_M_DSP_MPORT_BKE_HEALTH_1_ADDR A:0x6040c344
y.create.l HWIO_BIMC_M_DSP_MPORT_BKE_HEALTH_2_ADDR A:0x6040c348
y.create.l HWIO_BIMC_M_DSP_MPORT_BKE_HEALTH_3_ADDR A:0x6040c34c
y.create.l HWIO_BIMC_M_DSP_MPORT_STATUS_2A_ADDR A:0x6040c420
y.create.l HWIO_BIMC_M_DSP_MPORT_STATUS_2B_ADDR A:0x6040c424
y.create.l HWIO_BIMC_M_DSP_MPORT_STATUS_3A_ADDR A:0x6040c430
y.create.l HWIO_BIMC_M_DSP_MPORT_STATUS_3B_ADDR A:0x6040c434
y.create.l HWIO_BIMC_M_DSP_PROF_COMPONENT_INFO_ADDR A:0x6040d000
y.create.l HWIO_BIMC_M_DSP_PROF_CONFIGURATION_INFO_0_ADDR A:0x6040d020
y.create.l HWIO_BIMC_M_DSP_PROF_CONFIGURATION_INFO_1_ADDR A:0x6040d030
y.create.l HWIO_BIMC_M_DSP_PROF_CLOCK_CTRL_ADDR A:0x6040d200
y.create.l HWIO_BIMC_M_DSP_PROF_MODE_ADDR A:0x6040d210
y.create.l HWIO_BIMC_M_DSP_PROF_RD_TENURE_THRESHOLD_ADDR A:0x6040d214
y.create.l HWIO_BIMC_M_DSP_PROF_WR_TENURE_THRESHOLD_ADDR A:0x6040d218
y.create.l HWIO_BIMC_M_DSP_PROF_SWAY_SELECT_ADDR A:0x6040d220
y.create.l HWIO_BIMC_M_DSP_PROF_MID_MASK_ADDR A:0x6040d230
y.create.l HWIO_BIMC_M_DSP_PROF_MID_MATCH_ADDR A:0x6040d234
y.create.l HWIO_BIMC_M_DSP_PROF_MID_INV_MATCH_ADDR A:0x6040d238
y.create.l HWIO_BIMC_M_DSP_PROF_ADDR_MASK_LOWER_ADDR A:0x6040d240
y.create.l HWIO_BIMC_M_DSP_PROF_ADDR_MASK_UPPER_ADDR A:0x6040d244
y.create.l HWIO_BIMC_M_DSP_PROF_ADDR_MATCH_LOWER_ADDR A:0x6040d248
y.create.l HWIO_BIMC_M_DSP_PROF_ADDR_MATCH_UPPER_ADDR A:0x6040d24c
y.create.l HWIO_BIMC_M_DSP_PROF_ADDR_INV_MATCH_ADDR A:0x6040d250
y.create.l HWIO_BIMC_M_DSP_PROF_ACH_MASK_0_ADDR A:0x6040d260
y.create.l HWIO_BIMC_M_DSP_PROF_ACH_MATCH_0_ADDR A:0x6040d264
y.create.l HWIO_BIMC_M_DSP_PROF_ACH_MASK_1_ADDR A:0x6040d270
y.create.l HWIO_BIMC_M_DSP_PROF_ACH_MATCH_1_ADDR A:0x6040d274
y.create.l HWIO_BIMC_M_DSP_PROF_ACH_INV_MATCH_1_ADDR A:0x6040d278
y.create.l HWIO_BIMC_M_DSP_PROF_ACH_MASK_2_ADDR A:0x6040d280
y.create.l HWIO_BIMC_M_DSP_PROF_ACH_MATCH_2_ADDR A:0x6040d284
y.create.l HWIO_BIMC_M_DSP_PROF_ACH_MASK_3_ADDR A:0x6040d290
y.create.l HWIO_BIMC_M_DSP_PROF_ACH_MATCH_3_ADDR A:0x6040d294
y.create.l HWIO_BIMC_M_DSP_PROF_ACH_INV_MATCH_3_ADDR A:0x6040d298
y.create.l HWIO_BIMC_M_DSP_PROF_ACH_MASK_4_ADDR A:0x6040d2a0
y.create.l HWIO_BIMC_M_DSP_PROF_ACH_MATCH_4_ADDR A:0x6040d2a4
y.create.l HWIO_BIMC_M_DSP_PROF_ACH_INV_MATCH_4_ADDR A:0x6040d2a8
y.create.l HWIO_BIMC_M_DSP_PROF_BCH_MASK_ADDR A:0x6040d300
y.create.l HWIO_BIMC_M_DSP_PROF_BCH_MATCH_ADDR A:0x6040d304
y.create.l HWIO_BIMC_M_DSP_PROF_BCH_INV_MATCH_ADDR A:0x6040d308
y.create.l HWIO_BIMC_M_DSP_PROF_RCH_MASK_ADDR A:0x6040d340
y.create.l HWIO_BIMC_M_DSP_PROF_RCH_MATCH_ADDR A:0x6040d344
y.create.l HWIO_BIMC_M_DSP_PROF_RCH_INV_MATCH_ADDR A:0x6040d348
y.create.l HWIO_BIMC_M_DSP_PROF_RD_STATUS_0_ADDR A:0x6040d400
y.create.l HWIO_BIMC_M_DSP_PROF_WR_STATUS_0_ADDR A:0x6040d410
y.create.l HWIO_BIMC_M_MCDMA_MPORT_COMPONENT_INFO_ADDR A:0x60410000
y.create.l HWIO_BIMC_M_MCDMA_MPORT_CONFIGURATION_INFO_0_ADDR A:0x60410020
y.create.l HWIO_BIMC_M_MCDMA_MPORT_CONFIGURATION_INFO_1_ADDR A:0x60410030
y.create.l HWIO_BIMC_M_MCDMA_MPORT_CONFIGURATION_INFO_2A_ADDR A:0x60410040
y.create.l HWIO_BIMC_M_MCDMA_MPORT_CONFIGURATION_INFO_2B_ADDR A:0x60410044
y.create.l HWIO_BIMC_M_MCDMA_MPORT_CONFIGURATION_INFO_3_ADDR A:0x60410050
y.create.l HWIO_BIMC_M_MCDMA_MPORT_CONFIGURATION_INFO_4_ADDR A:0x60410060
y.create.l HWIO_BIMC_M_MCDMA_MPORT_CONFIGURATION_INFO_5A_ADDR A:0x60410070
y.create.l HWIO_BIMC_M_MCDMA_MPORT_CONFIGURATION_INFO_5B_ADDR A:0x60410074
y.create.l HWIO_BIMC_M_MCDMA_MPORT_CONFIGURATION_INFO_5C_ADDR A:0x60410078
y.create.l HWIO_BIMC_M_MCDMA_MPORT_CONFIGURATION_INFO_5D_ADDR A:0x6041007c
y.create.l HWIO_BIMC_M_MCDMA_MPORT_INTERRUPT_STATUS_ADDR A:0x60410100
y.create.l HWIO_BIMC_M_MCDMA_MPORT_INTERRUPT_CLEAR_ADDR A:0x60410108
y.create.l HWIO_BIMC_M_MCDMA_MPORT_INTERRUPT_ENABLE_ADDR A:0x6041010c
y.create.l HWIO_BIMC_M_MCDMA_MPORT_CLOCK_CTRL_ADDR A:0x60410200
y.create.l HWIO_BIMC_M_MCDMA_MPORT_CDC_CTRL_ADDR A:0x60410208
y.create.l HWIO_BIMC_M_MCDMA_MPORT_MODE_ADDR A:0x60410210
y.create.l HWIO_BIMC_M_MCDMA_MPORT_WR_WAY_CROSSING_ADDR A:0x60410220
y.create.l HWIO_BIMC_M_MCDMA_MPORT_PRIORITYLVL_OVERRIDE_ADDR A:0x60410230
y.create.l HWIO_BIMC_M_MCDMA_MPORT_READ_COMMAND_OVERRIDE_ADDR A:0x60410240
y.create.l HWIO_BIMC_M_MCDMA_MPORT_WRITE_COMMAND_OVERRIDE_ADDR A:0x60410250
y.create.l HWIO_BIMC_M_MCDMA_MPORT_RD_TRACKING_INDEX_ADDR A:0x60410270
y.create.l HWIO_BIMC_M_MCDMA_MPORT_WR_TRACKING_INDEX_ADDR A:0x60410274
y.create.l HWIO_BIMC_M_MCDMA_MPORT_BKE_ENABLE_ADDR A:0x60410300
y.create.l HWIO_BIMC_M_MCDMA_MPORT_BKE_GRANT_PERIOD_ADDR A:0x60410304
y.create.l HWIO_BIMC_M_MCDMA_MPORT_BKE_GRANT_COUNT_ADDR A:0x60410308
y.create.l HWIO_BIMC_M_MCDMA_MPORT_BKE_THRESHOLD_HIGH_ADDR A:0x60410320
y.create.l HWIO_BIMC_M_MCDMA_MPORT_BKE_THRESHOLD_MEDIUM_ADDR A:0x60410324
y.create.l HWIO_BIMC_M_MCDMA_MPORT_BKE_THRESHOLD_LOW_ADDR A:0x60410328
y.create.l HWIO_BIMC_M_MCDMA_MPORT_BKE_HEALTH_0_ADDR A:0x60410340
y.create.l HWIO_BIMC_M_MCDMA_MPORT_BKE_HEALTH_1_ADDR A:0x60410344
y.create.l HWIO_BIMC_M_MCDMA_MPORT_BKE_HEALTH_2_ADDR A:0x60410348
y.create.l HWIO_BIMC_M_MCDMA_MPORT_BKE_HEALTH_3_ADDR A:0x6041034c
y.create.l HWIO_BIMC_M_MCDMA_MPORT_STATUS_2A_ADDR A:0x60410420
y.create.l HWIO_BIMC_M_MCDMA_MPORT_STATUS_2B_ADDR A:0x60410424
y.create.l HWIO_BIMC_M_MCDMA_MPORT_STATUS_3A_ADDR A:0x60410430
y.create.l HWIO_BIMC_M_MCDMA_MPORT_STATUS_3B_ADDR A:0x60410434
y.create.l HWIO_BIMC_M_MCDMA_PROF_COMPONENT_INFO_ADDR A:0x60411000
y.create.l HWIO_BIMC_M_MCDMA_PROF_CONFIGURATION_INFO_0_ADDR A:0x60411020
y.create.l HWIO_BIMC_M_MCDMA_PROF_CONFIGURATION_INFO_1_ADDR A:0x60411030
y.create.l HWIO_BIMC_M_MCDMA_PROF_CLOCK_CTRL_ADDR A:0x60411200
y.create.l HWIO_BIMC_M_MCDMA_PROF_MODE_ADDR A:0x60411210
y.create.l HWIO_BIMC_M_MCDMA_PROF_RD_TENURE_THRESHOLD_ADDR A:0x60411214
y.create.l HWIO_BIMC_M_MCDMA_PROF_WR_TENURE_THRESHOLD_ADDR A:0x60411218
y.create.l HWIO_BIMC_M_MCDMA_PROF_SWAY_SELECT_ADDR A:0x60411220
y.create.l HWIO_BIMC_M_MCDMA_PROF_MID_MASK_ADDR A:0x60411230
y.create.l HWIO_BIMC_M_MCDMA_PROF_MID_MATCH_ADDR A:0x60411234
y.create.l HWIO_BIMC_M_MCDMA_PROF_MID_INV_MATCH_ADDR A:0x60411238
y.create.l HWIO_BIMC_M_MCDMA_PROF_ADDR_MASK_LOWER_ADDR A:0x60411240
y.create.l HWIO_BIMC_M_MCDMA_PROF_ADDR_MASK_UPPER_ADDR A:0x60411244
y.create.l HWIO_BIMC_M_MCDMA_PROF_ADDR_MATCH_LOWER_ADDR A:0x60411248
y.create.l HWIO_BIMC_M_MCDMA_PROF_ADDR_MATCH_UPPER_ADDR A:0x6041124c
y.create.l HWIO_BIMC_M_MCDMA_PROF_ADDR_INV_MATCH_ADDR A:0x60411250
y.create.l HWIO_BIMC_M_MCDMA_PROF_ACH_MASK_0_ADDR A:0x60411260
y.create.l HWIO_BIMC_M_MCDMA_PROF_ACH_MATCH_0_ADDR A:0x60411264
y.create.l HWIO_BIMC_M_MCDMA_PROF_ACH_MASK_1_ADDR A:0x60411270
y.create.l HWIO_BIMC_M_MCDMA_PROF_ACH_MATCH_1_ADDR A:0x60411274
y.create.l HWIO_BIMC_M_MCDMA_PROF_ACH_INV_MATCH_1_ADDR A:0x60411278
y.create.l HWIO_BIMC_M_MCDMA_PROF_ACH_MASK_2_ADDR A:0x60411280
y.create.l HWIO_BIMC_M_MCDMA_PROF_ACH_MATCH_2_ADDR A:0x60411284
y.create.l HWIO_BIMC_M_MCDMA_PROF_ACH_MASK_3_ADDR A:0x60411290
y.create.l HWIO_BIMC_M_MCDMA_PROF_ACH_MATCH_3_ADDR A:0x60411294
y.create.l HWIO_BIMC_M_MCDMA_PROF_ACH_INV_MATCH_3_ADDR A:0x60411298
y.create.l HWIO_BIMC_M_MCDMA_PROF_ACH_MASK_4_ADDR A:0x604112a0
y.create.l HWIO_BIMC_M_MCDMA_PROF_ACH_MATCH_4_ADDR A:0x604112a4
y.create.l HWIO_BIMC_M_MCDMA_PROF_ACH_INV_MATCH_4_ADDR A:0x604112a8
y.create.l HWIO_BIMC_M_MCDMA_PROF_BCH_MASK_ADDR A:0x60411300
y.create.l HWIO_BIMC_M_MCDMA_PROF_BCH_MATCH_ADDR A:0x60411304
y.create.l HWIO_BIMC_M_MCDMA_PROF_BCH_INV_MATCH_ADDR A:0x60411308
y.create.l HWIO_BIMC_M_MCDMA_PROF_RCH_MASK_ADDR A:0x60411340
y.create.l HWIO_BIMC_M_MCDMA_PROF_RCH_MATCH_ADDR A:0x60411344
y.create.l HWIO_BIMC_M_MCDMA_PROF_RCH_INV_MATCH_ADDR A:0x60411348
y.create.l HWIO_BIMC_M_MCDMA_PROF_RD_STATUS_0_ADDR A:0x60411400
y.create.l HWIO_BIMC_M_MCDMA_PROF_WR_STATUS_0_ADDR A:0x60411410
y.create.l HWIO_BIMC_M_SYS_MPORT_COMPONENT_INFO_ADDR A:0x60414000
y.create.l HWIO_BIMC_M_SYS_MPORT_CONFIGURATION_INFO_0_ADDR A:0x60414020
y.create.l HWIO_BIMC_M_SYS_MPORT_CONFIGURATION_INFO_1_ADDR A:0x60414030
y.create.l HWIO_BIMC_M_SYS_MPORT_CONFIGURATION_INFO_2A_ADDR A:0x60414040
y.create.l HWIO_BIMC_M_SYS_MPORT_CONFIGURATION_INFO_2B_ADDR A:0x60414044
y.create.l HWIO_BIMC_M_SYS_MPORT_CONFIGURATION_INFO_3_ADDR A:0x60414050
y.create.l HWIO_BIMC_M_SYS_MPORT_CONFIGURATION_INFO_4_ADDR A:0x60414060
y.create.l HWIO_BIMC_M_SYS_MPORT_CONFIGURATION_INFO_5A_ADDR A:0x60414070
y.create.l HWIO_BIMC_M_SYS_MPORT_CONFIGURATION_INFO_5B_ADDR A:0x60414074
y.create.l HWIO_BIMC_M_SYS_MPORT_CONFIGURATION_INFO_5C_ADDR A:0x60414078
y.create.l HWIO_BIMC_M_SYS_MPORT_CONFIGURATION_INFO_5D_ADDR A:0x6041407c
y.create.l HWIO_BIMC_M_SYS_MPORT_INTERRUPT_STATUS_ADDR A:0x60414100
y.create.l HWIO_BIMC_M_SYS_MPORT_INTERRUPT_CLEAR_ADDR A:0x60414108
y.create.l HWIO_BIMC_M_SYS_MPORT_INTERRUPT_ENABLE_ADDR A:0x6041410c
y.create.l HWIO_BIMC_M_SYS_MPORT_CLOCK_CTRL_ADDR A:0x60414200
y.create.l HWIO_BIMC_M_SYS_MPORT_CDC_CTRL_ADDR A:0x60414208
y.create.l HWIO_BIMC_M_SYS_MPORT_MODE_ADDR A:0x60414210
y.create.l HWIO_BIMC_M_SYS_MPORT_WR_WAY_CROSSING_ADDR A:0x60414220
y.create.l HWIO_BIMC_M_SYS_MPORT_PRIORITYLVL_OVERRIDE_ADDR A:0x60414230
y.create.l HWIO_BIMC_M_SYS_MPORT_READ_COMMAND_OVERRIDE_ADDR A:0x60414240
y.create.l HWIO_BIMC_M_SYS_MPORT_WRITE_COMMAND_OVERRIDE_ADDR A:0x60414250
y.create.l HWIO_BIMC_M_SYS_MPORT_RD_TRACKING_INDEX_ADDR A:0x60414270
y.create.l HWIO_BIMC_M_SYS_MPORT_WR_TRACKING_INDEX_ADDR A:0x60414274
y.create.l HWIO_BIMC_M_SYS_MPORT_BKE_ENABLE_ADDR A:0x60414300
y.create.l HWIO_BIMC_M_SYS_MPORT_BKE_GRANT_PERIOD_ADDR A:0x60414304
y.create.l HWIO_BIMC_M_SYS_MPORT_BKE_GRANT_COUNT_ADDR A:0x60414308
y.create.l HWIO_BIMC_M_SYS_MPORT_BKE_THRESHOLD_HIGH_ADDR A:0x60414320
y.create.l HWIO_BIMC_M_SYS_MPORT_BKE_THRESHOLD_MEDIUM_ADDR A:0x60414324
y.create.l HWIO_BIMC_M_SYS_MPORT_BKE_THRESHOLD_LOW_ADDR A:0x60414328
y.create.l HWIO_BIMC_M_SYS_MPORT_BKE_HEALTH_0_ADDR A:0x60414340
y.create.l HWIO_BIMC_M_SYS_MPORT_BKE_HEALTH_1_ADDR A:0x60414344
y.create.l HWIO_BIMC_M_SYS_MPORT_BKE_HEALTH_2_ADDR A:0x60414348
y.create.l HWIO_BIMC_M_SYS_MPORT_BKE_HEALTH_3_ADDR A:0x6041434c
y.create.l HWIO_BIMC_M_SYS_MPORT_STATUS_2A_ADDR A:0x60414420
y.create.l HWIO_BIMC_M_SYS_MPORT_STATUS_2B_ADDR A:0x60414424
y.create.l HWIO_BIMC_M_SYS_MPORT_STATUS_3A_ADDR A:0x60414430
y.create.l HWIO_BIMC_M_SYS_MPORT_STATUS_3B_ADDR A:0x60414434
y.create.l HWIO_BIMC_M_SYS_PROF_COMPONENT_INFO_ADDR A:0x60415000
y.create.l HWIO_BIMC_M_SYS_PROF_CONFIGURATION_INFO_0_ADDR A:0x60415020
y.create.l HWIO_BIMC_M_SYS_PROF_CONFIGURATION_INFO_1_ADDR A:0x60415030
y.create.l HWIO_BIMC_M_SYS_PROF_CLOCK_CTRL_ADDR A:0x60415200
y.create.l HWIO_BIMC_M_SYS_PROF_MODE_ADDR A:0x60415210
y.create.l HWIO_BIMC_M_SYS_PROF_RD_TENURE_THRESHOLD_ADDR A:0x60415214
y.create.l HWIO_BIMC_M_SYS_PROF_WR_TENURE_THRESHOLD_ADDR A:0x60415218
y.create.l HWIO_BIMC_M_SYS_PROF_SWAY_SELECT_ADDR A:0x60415220
y.create.l HWIO_BIMC_M_SYS_PROF_MID_MASK_ADDR A:0x60415230
y.create.l HWIO_BIMC_M_SYS_PROF_MID_MATCH_ADDR A:0x60415234
y.create.l HWIO_BIMC_M_SYS_PROF_MID_INV_MATCH_ADDR A:0x60415238
y.create.l HWIO_BIMC_M_SYS_PROF_ADDR_MASK_LOWER_ADDR A:0x60415240
y.create.l HWIO_BIMC_M_SYS_PROF_ADDR_MASK_UPPER_ADDR A:0x60415244
y.create.l HWIO_BIMC_M_SYS_PROF_ADDR_MATCH_LOWER_ADDR A:0x60415248
y.create.l HWIO_BIMC_M_SYS_PROF_ADDR_MATCH_UPPER_ADDR A:0x6041524c
y.create.l HWIO_BIMC_M_SYS_PROF_ADDR_INV_MATCH_ADDR A:0x60415250
y.create.l HWIO_BIMC_M_SYS_PROF_ACH_MASK_0_ADDR A:0x60415260
y.create.l HWIO_BIMC_M_SYS_PROF_ACH_MATCH_0_ADDR A:0x60415264
y.create.l HWIO_BIMC_M_SYS_PROF_ACH_MASK_1_ADDR A:0x60415270
y.create.l HWIO_BIMC_M_SYS_PROF_ACH_MATCH_1_ADDR A:0x60415274
y.create.l HWIO_BIMC_M_SYS_PROF_ACH_INV_MATCH_1_ADDR A:0x60415278
y.create.l HWIO_BIMC_M_SYS_PROF_ACH_MASK_2_ADDR A:0x60415280
y.create.l HWIO_BIMC_M_SYS_PROF_ACH_MATCH_2_ADDR A:0x60415284
y.create.l HWIO_BIMC_M_SYS_PROF_ACH_MASK_3_ADDR A:0x60415290
y.create.l HWIO_BIMC_M_SYS_PROF_ACH_MATCH_3_ADDR A:0x60415294
y.create.l HWIO_BIMC_M_SYS_PROF_ACH_INV_MATCH_3_ADDR A:0x60415298
y.create.l HWIO_BIMC_M_SYS_PROF_ACH_MASK_4_ADDR A:0x604152a0
y.create.l HWIO_BIMC_M_SYS_PROF_ACH_MATCH_4_ADDR A:0x604152a4
y.create.l HWIO_BIMC_M_SYS_PROF_ACH_INV_MATCH_4_ADDR A:0x604152a8
y.create.l HWIO_BIMC_M_SYS_PROF_BCH_MASK_ADDR A:0x60415300
y.create.l HWIO_BIMC_M_SYS_PROF_BCH_MATCH_ADDR A:0x60415304
y.create.l HWIO_BIMC_M_SYS_PROF_BCH_INV_MATCH_ADDR A:0x60415308
y.create.l HWIO_BIMC_M_SYS_PROF_RCH_MASK_ADDR A:0x60415340
y.create.l HWIO_BIMC_M_SYS_PROF_RCH_MATCH_ADDR A:0x60415344
y.create.l HWIO_BIMC_M_SYS_PROF_RCH_INV_MATCH_ADDR A:0x60415348
y.create.l HWIO_BIMC_M_SYS_PROF_RD_STATUS_0_ADDR A:0x60415400
y.create.l HWIO_BIMC_M_SYS_PROF_WR_STATUS_0_ADDR A:0x60415410
y.create.l HWIO_BIMC_M_TCU_MPORT_COMPONENT_INFO_ADDR A:0x60418000
y.create.l HWIO_BIMC_M_TCU_MPORT_CONFIGURATION_INFO_0_ADDR A:0x60418020
y.create.l HWIO_BIMC_M_TCU_MPORT_CONFIGURATION_INFO_1_ADDR A:0x60418030
y.create.l HWIO_BIMC_M_TCU_MPORT_CONFIGURATION_INFO_2A_ADDR A:0x60418040
y.create.l HWIO_BIMC_M_TCU_MPORT_CONFIGURATION_INFO_2B_ADDR A:0x60418044
y.create.l HWIO_BIMC_M_TCU_MPORT_CONFIGURATION_INFO_3_ADDR A:0x60418050
y.create.l HWIO_BIMC_M_TCU_MPORT_CONFIGURATION_INFO_4_ADDR A:0x60418060
y.create.l HWIO_BIMC_M_TCU_MPORT_CONFIGURATION_INFO_5A_ADDR A:0x60418070
y.create.l HWIO_BIMC_M_TCU_MPORT_CONFIGURATION_INFO_5B_ADDR A:0x60418074
y.create.l HWIO_BIMC_M_TCU_MPORT_CONFIGURATION_INFO_5C_ADDR A:0x60418078
y.create.l HWIO_BIMC_M_TCU_MPORT_CONFIGURATION_INFO_5D_ADDR A:0x6041807c
y.create.l HWIO_BIMC_M_TCU_MPORT_INTERRUPT_STATUS_ADDR A:0x60418100
y.create.l HWIO_BIMC_M_TCU_MPORT_INTERRUPT_CLEAR_ADDR A:0x60418108
y.create.l HWIO_BIMC_M_TCU_MPORT_INTERRUPT_ENABLE_ADDR A:0x6041810c
y.create.l HWIO_BIMC_M_TCU_MPORT_CLOCK_CTRL_ADDR A:0x60418200
y.create.l HWIO_BIMC_M_TCU_MPORT_CDC_CTRL_ADDR A:0x60418208
y.create.l HWIO_BIMC_M_TCU_MPORT_MODE_ADDR A:0x60418210
y.create.l HWIO_BIMC_M_TCU_MPORT_WR_WAY_CROSSING_ADDR A:0x60418220
y.create.l HWIO_BIMC_M_TCU_MPORT_PRIORITYLVL_OVERRIDE_ADDR A:0x60418230
y.create.l HWIO_BIMC_M_TCU_MPORT_READ_COMMAND_OVERRIDE_ADDR A:0x60418240
y.create.l HWIO_BIMC_M_TCU_MPORT_WRITE_COMMAND_OVERRIDE_ADDR A:0x60418250
y.create.l HWIO_BIMC_M_TCU_MPORT_RD_TRACKING_INDEX_ADDR A:0x60418270
y.create.l HWIO_BIMC_M_TCU_MPORT_WR_TRACKING_INDEX_ADDR A:0x60418274
y.create.l HWIO_BIMC_M_TCU_MPORT_BKE_ENABLE_ADDR A:0x60418300
y.create.l HWIO_BIMC_M_TCU_MPORT_BKE_GRANT_PERIOD_ADDR A:0x60418304
y.create.l HWIO_BIMC_M_TCU_MPORT_BKE_GRANT_COUNT_ADDR A:0x60418308
y.create.l HWIO_BIMC_M_TCU_MPORT_BKE_THRESHOLD_HIGH_ADDR A:0x60418320
y.create.l HWIO_BIMC_M_TCU_MPORT_BKE_THRESHOLD_MEDIUM_ADDR A:0x60418324
y.create.l HWIO_BIMC_M_TCU_MPORT_BKE_THRESHOLD_LOW_ADDR A:0x60418328
y.create.l HWIO_BIMC_M_TCU_MPORT_BKE_HEALTH_0_ADDR A:0x60418340
y.create.l HWIO_BIMC_M_TCU_MPORT_BKE_HEALTH_1_ADDR A:0x60418344
y.create.l HWIO_BIMC_M_TCU_MPORT_BKE_HEALTH_2_ADDR A:0x60418348
y.create.l HWIO_BIMC_M_TCU_MPORT_BKE_HEALTH_3_ADDR A:0x6041834c
y.create.l HWIO_BIMC_M_TCU_MPORT_STATUS_2A_ADDR A:0x60418420
y.create.l HWIO_BIMC_M_TCU_MPORT_STATUS_2B_ADDR A:0x60418424
y.create.l HWIO_BIMC_M_TCU_MPORT_STATUS_3A_ADDR A:0x60418430
y.create.l HWIO_BIMC_M_TCU_MPORT_STATUS_3B_ADDR A:0x60418434
y.create.l HWIO_BIMC_M_TCU_PROF_COMPONENT_INFO_ADDR A:0x60419000
y.create.l HWIO_BIMC_M_TCU_PROF_CONFIGURATION_INFO_0_ADDR A:0x60419020
y.create.l HWIO_BIMC_M_TCU_PROF_CONFIGURATION_INFO_1_ADDR A:0x60419030
y.create.l HWIO_BIMC_M_TCU_PROF_CLOCK_CTRL_ADDR A:0x60419200
y.create.l HWIO_BIMC_M_TCU_PROF_MODE_ADDR A:0x60419210
y.create.l HWIO_BIMC_M_TCU_PROF_RD_TENURE_THRESHOLD_ADDR A:0x60419214
y.create.l HWIO_BIMC_M_TCU_PROF_WR_TENURE_THRESHOLD_ADDR A:0x60419218
y.create.l HWIO_BIMC_M_TCU_PROF_SWAY_SELECT_ADDR A:0x60419220
y.create.l HWIO_BIMC_M_TCU_PROF_MID_MASK_ADDR A:0x60419230
y.create.l HWIO_BIMC_M_TCU_PROF_MID_MATCH_ADDR A:0x60419234
y.create.l HWIO_BIMC_M_TCU_PROF_MID_INV_MATCH_ADDR A:0x60419238
y.create.l HWIO_BIMC_M_TCU_PROF_ADDR_MASK_LOWER_ADDR A:0x60419240
y.create.l HWIO_BIMC_M_TCU_PROF_ADDR_MASK_UPPER_ADDR A:0x60419244
y.create.l HWIO_BIMC_M_TCU_PROF_ADDR_MATCH_LOWER_ADDR A:0x60419248
y.create.l HWIO_BIMC_M_TCU_PROF_ADDR_MATCH_UPPER_ADDR A:0x6041924c
y.create.l HWIO_BIMC_M_TCU_PROF_ADDR_INV_MATCH_ADDR A:0x60419250
y.create.l HWIO_BIMC_M_TCU_PROF_ACH_MASK_0_ADDR A:0x60419260
y.create.l HWIO_BIMC_M_TCU_PROF_ACH_MATCH_0_ADDR A:0x60419264
y.create.l HWIO_BIMC_M_TCU_PROF_ACH_MASK_1_ADDR A:0x60419270
y.create.l HWIO_BIMC_M_TCU_PROF_ACH_MATCH_1_ADDR A:0x60419274
y.create.l HWIO_BIMC_M_TCU_PROF_ACH_INV_MATCH_1_ADDR A:0x60419278
y.create.l HWIO_BIMC_M_TCU_PROF_ACH_MASK_2_ADDR A:0x60419280
y.create.l HWIO_BIMC_M_TCU_PROF_ACH_MATCH_2_ADDR A:0x60419284
y.create.l HWIO_BIMC_M_TCU_PROF_ACH_MASK_3_ADDR A:0x60419290
y.create.l HWIO_BIMC_M_TCU_PROF_ACH_MATCH_3_ADDR A:0x60419294
y.create.l HWIO_BIMC_M_TCU_PROF_ACH_INV_MATCH_3_ADDR A:0x60419298
y.create.l HWIO_BIMC_M_TCU_PROF_ACH_MASK_4_ADDR A:0x604192a0
y.create.l HWIO_BIMC_M_TCU_PROF_ACH_MATCH_4_ADDR A:0x604192a4
y.create.l HWIO_BIMC_M_TCU_PROF_ACH_INV_MATCH_4_ADDR A:0x604192a8
y.create.l HWIO_BIMC_M_TCU_PROF_BCH_MASK_ADDR A:0x60419300
y.create.l HWIO_BIMC_M_TCU_PROF_BCH_MATCH_ADDR A:0x60419304
y.create.l HWIO_BIMC_M_TCU_PROF_BCH_INV_MATCH_ADDR A:0x60419308
y.create.l HWIO_BIMC_M_TCU_PROF_RCH_MASK_ADDR A:0x60419340
y.create.l HWIO_BIMC_M_TCU_PROF_RCH_MATCH_ADDR A:0x60419344
y.create.l HWIO_BIMC_M_TCU_PROF_RCH_INV_MATCH_ADDR A:0x60419348
y.create.l HWIO_BIMC_M_TCU_PROF_RD_STATUS_0_ADDR A:0x60419400
y.create.l HWIO_BIMC_M_TCU_PROF_WR_STATUS_0_ADDR A:0x60419410
y.create.l HWIO_BIMC_S_SYS_SWAY_COMPONENT_INFO_ADDR A:0x60450000
y.create.l HWIO_BIMC_S_SYS_SWAY_CONFIGURATION_INFO_0_ADDR A:0x60450020
y.create.l HWIO_BIMC_S_SYS_SWAY_CONFIGURATION_INFO_1_ADDR A:0x60450030
y.create.l HWIO_BIMC_S_SYS_SWAY_CONFIGURATION_INFO_2_ADDR A:0x60450040
y.create.l HWIO_BIMC_S_SYS_SWAY_CONFIGURATION_INFO_3_ADDR A:0x60450050
y.create.l HWIO_BIMC_S_SYS_SWAY_CONFIGURATION_INFO_4_ADDR A:0x60450060
y.create.l HWIO_BIMC_S_SYS_SWAY_CONFIGURATION_INFO_5_ADDR A:0x60450070
y.create.l HWIO_BIMC_S_SYS_SWAY_CONFIGURATION_INFO_6A_ADDR A:0x60450080
y.create.l HWIO_BIMC_S_SYS_SWAY_CONFIGURATION_INFO_6B_ADDR A:0x60450084
y.create.l HWIO_BIMC_S_SYS_SWAY_CONFIGURATION_INFO_6C_ADDR A:0x60450088
y.create.l HWIO_BIMC_S_SYS_SWAY_CONFIGURATION_INFO_6D_ADDR A:0x604500bc
y.create.l HWIO_BIMC_S_SYS_SWAY_INTERRUPT_STATUS_ADDR A:0x60450100
y.create.l HWIO_BIMC_S_SYS_SWAY_INTERRUPT_CLEAR_ADDR A:0x60450108
y.create.l HWIO_BIMC_S_SYS_SWAY_INTERRUPT_ENABLE_ADDR A:0x6045010c
y.create.l HWIO_BIMC_S_SYS_SWAY_CLOCK_CTRL_ADDR A:0x60450200
y.create.l HWIO_BIMC_S_SYS_SWAY_CDC_CTRL_ADDR A:0x60450208
y.create.l HWIO_BIMC_S_SYS_SWAY_RCH_SELECT_ADDR A:0x60450210
y.create.l HWIO_BIMC_S_SYS_SWAY_MAX_OUTSTANDING_REQUESTS_ADDR A:0x60450220
y.create.l HWIO_BIMC_S_SYS_SWAY_GATHERING_ADDR A:0x60450230
y.create.l HWIO_BIMC_S_SYS_SWAY_MODE_ADDR A:0x60450240
y.create.l HWIO_BIMC_S_SYS_SWAY_READ_COMMAND_OVERRIDE_ADDR A:0x60450250
y.create.l HWIO_BIMC_S_SYS_SWAY_WRITE_COMMAND_OVERRIDE_ADDR A:0x60450260
y.create.l HWIO_BIMC_S_SYS_SWAY_STATUS_0A_ADDR A:0x60450400
y.create.l HWIO_BIMC_S_SYS_SWAY_STATUS_0B_ADDR A:0x60450404
y.create.l HWIO_BIMC_S_SYS_SWAY_STATUS_0C_ADDR A:0x60450408
y.create.l HWIO_BIMC_S_SYS_SWAY_STATUS_0D_ADDR A:0x6045040c
y.create.l HWIO_BIMC_S_SYS_SWAY_STATUS_1A_ADDR A:0x60450410
y.create.l HWIO_BIMC_S_SYS_SWAY_STATUS_1B_ADDR A:0x60450414
y.create.l HWIO_BIMC_S_SYS_SWAY_STATUS_1C_ADDR A:0x60450418
y.create.l HWIO_BIMC_S_DEFAULT_SWAY_COMPONENT_INFO_ADDR A:0x60458000
y.create.l HWIO_BIMC_S_DEFAULT_SWAY_CONFIGURATION_INFO_0_ADDR A:0x60458020
y.create.l HWIO_BIMC_S_DEFAULT_SWAY_CONFIGURATION_INFO_1_ADDR A:0x60458030
y.create.l HWIO_BIMC_S_DEFAULT_SWAY_INTERRUPT_STATUS_ADDR A:0x60458100
y.create.l HWIO_BIMC_S_DEFAULT_SWAY_INTERRUPT_CLEAR_ADDR A:0x60458108
y.create.l HWIO_BIMC_S_DEFAULT_SWAY_INTERRUPT_ENABLE_ADDR A:0x6045810c
y.create.l HWIO_BIMC_S_DEFAULT_SWAY_DEFAULT_SLAVE_STATUS_0_ADDR A:0x60458400
y.create.l HWIO_BIMC_S_DEFAULT_SWAY_DEFAULT_SLAVE_STATUS_1_ADDR A:0x60458410
y.create.l HWIO_BIMC_S_DEFAULT_SWAY_DEFAULT_SLAVE_STATUS_2_ADDR A:0x60458420
y.create.l HWIO_BIMC_S_DDR0_ARB_COMPONENT_INFO_ADDR A:0x60449000
y.create.l HWIO_BIMC_S_DDR0_ARB_CONFIGURATION_INFO_0_ADDR A:0x60449020
y.create.l HWIO_BIMC_S_DDR0_ARB_CONFIGURATION_INFO_1_ADDR A:0x60449030
y.create.l HWIO_BIMC_S_DDR0_ARB_CLOCK_CTRL_ADDR A:0x60449200
y.create.l HWIO_BIMC_S_DDR0_ARB_MODE_ADDR A:0x60449210
y.create.l HWIO_BIMC_S_DDR0_ARB_MASTER0_GRANTS_ADDR A:0x60449220
y.create.l HWIO_BIMC_S_DDR0_ARB_MASTER1_GRANTS_ADDR A:0x60449224
y.create.l HWIO_BIMC_S_DDR0_ARB_MASTER2_GRANTS_ADDR A:0x60449228
y.create.l HWIO_BIMC_S_DDR0_ARB_MASTER3_GRANTS_ADDR A:0x6044922c
y.create.l HWIO_BIMC_S_DDR0_ARB_MASTER4_GRANTS_ADDR A:0x60449230
y.create.l HWIO_BIMC_S_SYS_ARB_COMPONENT_INFO_ADDR A:0x60451000
y.create.l HWIO_BIMC_S_SYS_ARB_CONFIGURATION_INFO_0_ADDR A:0x60451020
y.create.l HWIO_BIMC_S_SYS_ARB_CONFIGURATION_INFO_1_ADDR A:0x60451030
y.create.l HWIO_BIMC_S_SYS_ARB_CLOCK_CTRL_ADDR A:0x60451200
y.create.l HWIO_BIMC_S_SYS_ARB_MODE_ADDR A:0x60451210
y.create.l HWIO_BIMC_S_DEFAULT_ARB_COMPONENT_INFO_ADDR A:0x60459000
y.create.l HWIO_BIMC_S_DEFAULT_ARB_CONFIGURATION_INFO_0_ADDR A:0x60459020
y.create.l HWIO_BIMC_S_DEFAULT_ARB_CONFIGURATION_INFO_1_ADDR A:0x60459030
y.create.l HWIO_BIMC_S_DEFAULT_ARB_CLOCK_CTRL_ADDR A:0x60459200
y.create.l HWIO_BIMC_S_DEFAULT_ARB_MODE_ADDR A:0x60459210
y.create.l HWIO_BIMC_S_DDR0_SCMO_COMPONENT_INFO_ADDR A:0x60448000
y.create.l HWIO_BIMC_S_DDR0_SCMO_HW_INFO_ADDR A:0x60448010
y.create.l HWIO_BIMC_S_DDR0_SCMO_CONFIGURATION_INFO_0_ADDR A:0x60448020
y.create.l HWIO_BIMC_S_DDR0_SCMO_CONFIGURATION_INFO_1_ADDR A:0x60448030
y.create.l HWIO_BIMC_S_DDR0_SCMO_CONFIGURATION_INFO_2_ADDR A:0x60448040
y.create.l HWIO_BIMC_S_DDR0_SCMO_CONFIGURATION_INFO_3_ADDR A:0x60448050
y.create.l HWIO_BIMC_S_DDR0_SCMO_CONFIGURATION_INFO_4_ADDR A:0x60448060
y.create.l HWIO_BIMC_S_DDR0_SCMO_CONFIGURATION_INFO_5_ADDR A:0x60448070
y.create.l HWIO_BIMC_S_DDR0_SCMO_CONFIGURATION_INFO_6_ADDR A:0x60448080
y.create.l HWIO_BIMC_S_DDR0_SCMO_INTERRUPT_STATUS_ADDR A:0x60448100
y.create.l HWIO_BIMC_S_DDR0_SCMO_INTERRUPT_CLEAR_ADDR A:0x60448108
y.create.l HWIO_BIMC_S_DDR0_SCMO_INTERRUPT_ENABLE_ADDR A:0x6044810c
y.create.l HWIO_BIMC_S_DDR0_SCMO_ESYN_ADDR_ADDR A:0x60448120
y.create.l HWIO_BIMC_S_DDR0_SCMO_ESYN_APACKET_0_ADDR A:0x60448128
y.create.l HWIO_BIMC_S_DDR0_SCMO_ESYN_APACKET_1_ADDR A:0x6044812c
y.create.l HWIO_BIMC_S_DDR0_SCMO_ESYN_APACKET_2_ADDR A:0x60448130
y.create.l HWIO_BIMC_S_DDR0_SCMO_CLOCK_CTRL_ADDR A:0x60448200
y.create.l HWIO_BIMC_S_DDR0_SCMO_SLV_INTERLEAVE_CFG_ADDR A:0x60448400
y.create.l HWIO_BIMC_S_DDR0_SCMO_ADDR_BASE_CS0_ADDR A:0x60448410
y.create.l HWIO_BIMC_S_DDR0_SCMO_ADDR_BASE_CS1_ADDR A:0x60448414
y.create.l HWIO_BIMC_S_DDR0_SCMO_ADDR_MAP_CS0_ADDR A:0x60448420
y.create.l HWIO_BIMC_S_DDR0_SCMO_ADDR_MAP_CS1_ADDR A:0x60448424
y.create.l HWIO_BIMC_S_DDR0_SCMO_ADDR_MASK_CS0_ADDR A:0x60448430
y.create.l HWIO_BIMC_S_DDR0_SCMO_ADDR_MASK_CS1_ADDR A:0x60448434
y.create.l HWIO_BIMC_S_DDR0_SCMO_SLV_STATUS_ADDR A:0x60448450
y.create.l HWIO_BIMC_S_DDR0_SCMO_GLOBAL_MON_CFG_ADDR A:0x60448460
y.create.l HWIO_BIMC_S_DDR0_SCMO_CMD_BUF_CFG_ADDR A:0x60448500
y.create.l HWIO_BIMC_S_DDR0_SCMO_CMD_BUF_STATUS_ADDR A:0x60448520
y.create.l HWIO_BIMC_S_DDR0_SCMO_RCH_SELECT_ADDR A:0x60448540
y.create.l HWIO_BIMC_S_DDR0_SCMO_RCH_BKPR_CFG_ADDR A:0x60448544
y.create.l HWIO_BIMC_S_DDR0_SCMO_RCH_STATUS_ADDR A:0x60448560
y.create.l HWIO_BIMC_S_DDR0_SCMO_WCH_BUF_CFG_ADDR A:0x60448580
y.create.l HWIO_BIMC_S_DDR0_SCMO_WCH_STATUS_ADDR A:0x604485a0
y.create.l HWIO_BIMC_S_DDR0_SCMO_FLUSH_CFG_ADDR A:0x604485c0
y.create.l HWIO_BIMC_S_DDR0_SCMO_FLUSH_CMD_ADDR A:0x604485c4
y.create.l HWIO_BIMC_S_DDR0_SCMO_CMD_OPT_CFG0_ADDR A:0x60448700
y.create.l HWIO_BIMC_S_DDR0_SCMO_CMD_OPT_CFG1_ADDR A:0x60448704
y.create.l HWIO_BIMC_S_DDR0_SCMO_CMD_OPT_CFG2_ADDR A:0x60448708
y.create.l HWIO_BIMC_S_DDR0_SCMO_CMD_OPT_CFG3_ADDR A:0x6044870c
y.create.l HWIO_BIMC_S_DDR0_SCMO_CMD_OPT_CFG4_ADDR A:0x60448710
y.create.l HWIO_BIMC_S_DDR0_SCMO_FSP_STATUS_ADDR A:0x60448a40
y.create.l HWIO_BIMC_S_DDR0_XPU_SCR_ADDR A:0x6044a000
y.create.l HWIO_BIMC_S_DDR0_XPU_SWDR_ADDR A:0x6044a004
y.create.l HWIO_BIMC_S_DDR0_XPU_PRTN_RACR_SSHADOW_ADDR A:0x6044a008
y.create.l HWIO_BIMC_S_DDR0_XPU_PRTN_WACR_SSHADOW_ADDR A:0x6044a00c
y.create.l HWIO_BIMC_S_DDR0_XPU_PRTN_START_SSHADOW0_ADDR A:0x6044a010
y.create.l HWIO_BIMC_S_DDR0_XPU_PRTN_END_SSHADOW0_ADDR A:0x6044a018
y.create.l HWIO_BIMC_S_DDR0_XPU_SEAR0_ADDR A:0x6044a040
y.create.l HWIO_BIMC_S_DDR0_XPU_SESR_ADDR A:0x6044a048
y.create.l HWIO_BIMC_S_DDR0_XPU_SESRRESTORE_ADDR A:0x6044a04c
y.create.l HWIO_BIMC_S_DDR0_XPU_SESYNR0_ADDR A:0x6044a050
y.create.l HWIO_BIMC_S_DDR0_XPU_SESYNR1_ADDR A:0x6044a054
y.create.l HWIO_BIMC_S_DDR0_XPU_SESYNR2_ADDR A:0x6044a058
y.create.l HWIO_BIMC_S_DDR0_XPU_MCR_ADDR A:0x6044a100
y.create.l HWIO_BIMC_S_DDR0_XPU_MEAR0_ADDR A:0x6044a140
y.create.l HWIO_BIMC_S_DDR0_XPU_MESR_ADDR A:0x6044a148
y.create.l HWIO_BIMC_S_DDR0_XPU_MESRRESTORE_ADDR A:0x6044a14c
y.create.l HWIO_BIMC_S_DDR0_XPU_MESYNR0_ADDR A:0x6044a150
y.create.l HWIO_BIMC_S_DDR0_XPU_MESYNR1_ADDR A:0x6044a154
y.create.l HWIO_BIMC_S_DDR0_XPU_MESYNR2_ADDR A:0x6044a158
y.create.l HWIO_BIMC_S_DDR0_XPU_CR_ADDR A:0x6044a080
y.create.l HWIO_BIMC_S_DDR0_XPU_PRTN_RACR_SHADOW_ADDR A:0x6044a088
y.create.l HWIO_BIMC_S_DDR0_XPU_PRTN_WACR_SHADOW_ADDR A:0x6044a08c
y.create.l HWIO_BIMC_S_DDR0_XPU_PRTN_START_SHADOW0_ADDR A:0x6044a090
y.create.l HWIO_BIMC_S_DDR0_XPU_PRTN_END_SHADOW0_ADDR A:0x6044a098
y.create.l HWIO_BIMC_S_DDR0_XPU_RPU_ACR0_ADDR A:0x6044a0a0
y.create.l HWIO_BIMC_S_DDR0_XPU_EAR0_ADDR A:0x6044a0c0
y.create.l HWIO_BIMC_S_DDR0_XPU_ESR_ADDR A:0x6044a0c8
y.create.l HWIO_BIMC_S_DDR0_XPU_ESRRESTORE_ADDR A:0x6044a0cc
y.create.l HWIO_BIMC_S_DDR0_XPU_ESYNR0_ADDR A:0x6044a0d0
y.create.l HWIO_BIMC_S_DDR0_XPU_ESYNR1_ADDR A:0x6044a0d4
y.create.l HWIO_BIMC_S_DDR0_XPU_ESYNR2_ADDR A:0x6044a0d8
y.create.l HWIO_BIMC_S_DDR0_XPU_UMR_RACR_ADDR A:0x6044a0e0
y.create.l HWIO_BIMC_S_DDR0_XPU_UMR_WACR_ADDR A:0x6044a0e4
y.create.l HWIO_BIMC_S_DDR0_XPU_UMR_CNTL_ADDR A:0x6044a0f0
y.create.l HWIO_BIMC_S_DDR0_XPU_IDR0_ADDR A:0x6044a074
y.create.l HWIO_BIMC_S_DDR0_XPU_IDR1_ADDR A:0x6044a078
y.create.l HWIO_BIMC_S_DDR0_XPU_REV_ADDR A:0x6044a07c
y.create.l HWIO_BIMC_S_DDR0_XPU_PRT0_RACR0_ADDR A:0x6044a200
y.create.l HWIO_BIMC_S_DDR0_XPU_PRT1_RACR0_ADDR A:0x6044a280
y.create.l HWIO_BIMC_S_DDR0_XPU_PRT2_RACR0_ADDR A:0x6044a300
y.create.l HWIO_BIMC_S_DDR0_XPU_PRT3_RACR0_ADDR A:0x6044a380
y.create.l HWIO_BIMC_S_DDR0_XPU_PRT4_RACR0_ADDR A:0x6044a400
y.create.l HWIO_BIMC_S_DDR0_XPU_PRT5_RACR0_ADDR A:0x6044a480
y.create.l HWIO_BIMC_S_DDR0_XPU_PRT6_RACR0_ADDR A:0x6044a500
y.create.l HWIO_BIMC_S_DDR0_XPU_PRT7_RACR0_ADDR A:0x6044a580
y.create.l HWIO_BIMC_S_DDR0_XPU_PRT8_RACR0_ADDR A:0x6044a600
y.create.l HWIO_BIMC_S_DDR0_XPU_PRT9_RACR0_ADDR A:0x6044a680
y.create.l HWIO_BIMC_S_DDR0_XPU_PRT0_WACR0_ADDR A:0x6044a220
y.create.l HWIO_BIMC_S_DDR0_XPU_PRT1_WACR0_ADDR A:0x6044a2a0
y.create.l HWIO_BIMC_S_DDR0_XPU_PRT2_WACR0_ADDR A:0x6044a320
y.create.l HWIO_BIMC_S_DDR0_XPU_PRT3_WACR0_ADDR A:0x6044a3a0
y.create.l HWIO_BIMC_S_DDR0_XPU_PRT4_WACR0_ADDR A:0x6044a420
y.create.l HWIO_BIMC_S_DDR0_XPU_PRT5_WACR0_ADDR A:0x6044a4a0
y.create.l HWIO_BIMC_S_DDR0_XPU_PRT6_WACR0_ADDR A:0x6044a520
y.create.l HWIO_BIMC_S_DDR0_XPU_PRT7_WACR0_ADDR A:0x6044a5a0
y.create.l HWIO_BIMC_S_DDR0_XPU_PRT8_WACR0_ADDR A:0x6044a620
y.create.l HWIO_BIMC_S_DDR0_XPU_PRT9_WACR0_ADDR A:0x6044a6a0
y.create.l HWIO_BIMC_S_DDR0_XPU_PRT0_START0_ADDR A:0x6044a240
y.create.l HWIO_BIMC_S_DDR0_XPU_PRT1_START0_ADDR A:0x6044a2c0
y.create.l HWIO_BIMC_S_DDR0_XPU_PRT2_START0_ADDR A:0x6044a340
y.create.l HWIO_BIMC_S_DDR0_XPU_PRT3_START0_ADDR A:0x6044a3c0
y.create.l HWIO_BIMC_S_DDR0_XPU_PRT4_START0_ADDR A:0x6044a440
y.create.l HWIO_BIMC_S_DDR0_XPU_PRT5_START0_ADDR A:0x6044a4c0
y.create.l HWIO_BIMC_S_DDR0_XPU_PRT6_START0_ADDR A:0x6044a540
y.create.l HWIO_BIMC_S_DDR0_XPU_PRT7_START0_ADDR A:0x6044a5c0
y.create.l HWIO_BIMC_S_DDR0_XPU_PRT8_START0_ADDR A:0x6044a640
y.create.l HWIO_BIMC_S_DDR0_XPU_PRT9_START0_ADDR A:0x6044a6c0
y.create.l HWIO_BIMC_S_DDR0_XPU_PRT0_END0_ADDR A:0x6044a248
y.create.l HWIO_BIMC_S_DDR0_XPU_PRT1_END0_ADDR A:0x6044a2c8
y.create.l HWIO_BIMC_S_DDR0_XPU_PRT2_END0_ADDR A:0x6044a348
y.create.l HWIO_BIMC_S_DDR0_XPU_PRT3_END0_ADDR A:0x6044a3c8
y.create.l HWIO_BIMC_S_DDR0_XPU_PRT4_END0_ADDR A:0x6044a448
y.create.l HWIO_BIMC_S_DDR0_XPU_PRT5_END0_ADDR A:0x6044a4c8
y.create.l HWIO_BIMC_S_DDR0_XPU_PRT6_END0_ADDR A:0x6044a548
y.create.l HWIO_BIMC_S_DDR0_XPU_PRT7_END0_ADDR A:0x6044a5c8
y.create.l HWIO_BIMC_S_DDR0_XPU_PRT8_END0_ADDR A:0x6044a648
y.create.l HWIO_BIMC_S_DDR0_XPU_PRT9_END0_ADDR A:0x6044a6c8
y.create.l HWIO_BIMC_S_DDR0_XPU_PRT0_SCR_ADDR A:0x6044a250
y.create.l HWIO_BIMC_S_DDR0_XPU_PRT1_SCR_ADDR A:0x6044a2d0
y.create.l HWIO_BIMC_S_DDR0_XPU_PRT2_SCR_ADDR A:0x6044a350
y.create.l HWIO_BIMC_S_DDR0_XPU_PRT3_SCR_ADDR A:0x6044a3d0
y.create.l HWIO_BIMC_S_DDR0_XPU_PRT4_SCR_ADDR A:0x6044a450
y.create.l HWIO_BIMC_S_DDR0_XPU_PRT5_SCR_ADDR A:0x6044a4d0
y.create.l HWIO_BIMC_S_DDR0_XPU_PRT6_SCR_ADDR A:0x6044a550
y.create.l HWIO_BIMC_S_DDR0_XPU_PRT7_SCR_ADDR A:0x6044a5d0
y.create.l HWIO_BIMC_S_DDR0_XPU_PRT8_SCR_ADDR A:0x6044a650
y.create.l HWIO_BIMC_S_DDR0_XPU_PRT9_SCR_ADDR A:0x6044a6d0
y.create.l HWIO_BIMC_S_DDR0_XPU_PRT0_MCR_ADDR A:0x6044a254
y.create.l HWIO_BIMC_S_DDR0_XPU_PRT1_MCR_ADDR A:0x6044a2d4
y.create.l HWIO_BIMC_S_DDR0_XPU_PRT2_MCR_ADDR A:0x6044a354
y.create.l HWIO_BIMC_S_DDR0_XPU_PRT3_MCR_ADDR A:0x6044a3d4
y.create.l HWIO_BIMC_S_DDR0_XPU_PRT4_MCR_ADDR A:0x6044a454
y.create.l HWIO_BIMC_S_DDR0_XPU_PRT5_MCR_ADDR A:0x6044a4d4
y.create.l HWIO_BIMC_S_DDR0_XPU_PRT6_MCR_ADDR A:0x6044a554
y.create.l HWIO_BIMC_S_DDR0_XPU_PRT7_MCR_ADDR A:0x6044a5d4
y.create.l HWIO_BIMC_S_DDR0_XPU_PRT8_MCR_ADDR A:0x6044a654
y.create.l HWIO_BIMC_S_DDR0_XPU_PRT9_MCR_ADDR A:0x6044a6d4
y.create.l HWIO_BIMC_S_DDR0_XPU_PRT0_CNTL0_ADDR A:0x6044a258
y.create.l HWIO_BIMC_S_DDR0_XPU_PRT1_CNTL0_ADDR A:0x6044a2d8
y.create.l HWIO_BIMC_S_DDR0_XPU_PRT2_CNTL0_ADDR A:0x6044a358
y.create.l HWIO_BIMC_S_DDR0_XPU_PRT3_CNTL0_ADDR A:0x6044a3d8
y.create.l HWIO_BIMC_S_DDR0_XPU_PRT4_CNTL0_ADDR A:0x6044a458
y.create.l HWIO_BIMC_S_DDR0_XPU_PRT5_CNTL0_ADDR A:0x6044a4d8
y.create.l HWIO_BIMC_S_DDR0_XPU_PRT6_CNTL0_ADDR A:0x6044a558
y.create.l HWIO_BIMC_S_DDR0_XPU_PRT7_CNTL0_ADDR A:0x6044a5d8
y.create.l HWIO_BIMC_S_DDR0_XPU_PRT8_CNTL0_ADDR A:0x6044a658
y.create.l HWIO_BIMC_S_DDR0_XPU_PRT9_CNTL0_ADDR A:0x6044a6d8
y.create.l HWIO_BIMC_S_DDR0_XPU_PRT0_CNTL1_ADDR A:0x6044a25c
y.create.l HWIO_BIMC_S_DDR0_XPU_PRT1_CNTL1_ADDR A:0x6044a2dc
y.create.l HWIO_BIMC_S_DDR0_XPU_PRT2_CNTL1_ADDR A:0x6044a35c
y.create.l HWIO_BIMC_S_DDR0_XPU_PRT3_CNTL1_ADDR A:0x6044a3dc
y.create.l HWIO_BIMC_S_DDR0_XPU_PRT4_CNTL1_ADDR A:0x6044a45c
y.create.l HWIO_BIMC_S_DDR0_XPU_PRT5_CNTL1_ADDR A:0x6044a4dc
y.create.l HWIO_BIMC_S_DDR0_XPU_PRT6_CNTL1_ADDR A:0x6044a55c
y.create.l HWIO_BIMC_S_DDR0_XPU_PRT7_CNTL1_ADDR A:0x6044a5dc
y.create.l HWIO_BIMC_S_DDR0_XPU_PRT8_CNTL1_ADDR A:0x6044a65c
y.create.l HWIO_BIMC_S_DDR0_XPU_PRT9_CNTL1_ADDR A:0x6044a6dc
y.create.l HWIO_BIMC_S_DDR0_XPU_AMT_RACR_ADDR A:0x6044a0e8
y.create.l HWIO_BIMC_S_DDR0_XPU_AMT_WACR_ADDR A:0x6044a0ec
y.create.l HWIO_BIMC_S_DDR0_XPU_AMTR0_ADDR A:0x6044ae80
y.create.l HWIO_BIMC_S_DDR0_XPU_AMTR1_ADDR A:0x6044ae84
y.create.l HWIO_BIMC_S_DDR0_XPU_AMTR2_ADDR A:0x6044ae88
y.create.l HWIO_BIMC_S_DDR0_XPU_AMTR3_ADDR A:0x6044ae8c
y.create.l HWIO_BIMC_S_DDR0_XPU_AMTR4_ADDR A:0x6044ae90
y.create.l HWIO_BIMC_S_DDR0_XPU_AMTR5_ADDR A:0x6044ae94
y.create.l HWIO_BIMC_S_DDR0_XPU_AMTR6_ADDR A:0x6044ae98
y.create.l HWIO_BIMC_S_DDR0_XPU_AMTR7_ADDR A:0x6044ae9c
y.create.l HWIO_BIMC_S_DDR0_XPU_AMTR8_ADDR A:0x6044aea0
y.create.l HWIO_BIMC_S_DDR0_XPU_AMTR9_ADDR A:0x6044aea4
y.create.l HWIO_BIMC_S_DDR0_DPE_HW_INFO_ADDR A:0x6044c000
y.create.l HWIO_BIMC_S_DDR0_DPE_CONFIG_0_ADDR A:0x6044c010
y.create.l HWIO_BIMC_S_DDR0_DPE_CONFIG_1_ADDR A:0x6044c014
y.create.l HWIO_BIMC_S_DDR0_DPE_CONFIG_2_ADDR A:0x6044c018
y.create.l HWIO_BIMC_S_DDR0_DPE_CONFIG_3_ADDR A:0x6044c01c
y.create.l HWIO_BIMC_S_DDR0_DPE_CONFIG_4_ADDR A:0x6044c020
y.create.l HWIO_BIMC_S_DDR0_DPE_CONFIG_5_ADDR A:0x6044c024
y.create.l HWIO_BIMC_S_DDR0_DPE_CONFIG_6_ADDR A:0x6044c028
y.create.l HWIO_BIMC_S_DDR0_DPE_CONFIG_7_ADDR A:0x6044c02c
y.create.l HWIO_BIMC_S_DDR0_DPE_CONFIG_DQ_MAP_ADDR A:0x6044c038
y.create.l HWIO_BIMC_S_DDR0_DPE_ODT_CONFIG_0_ADDR A:0x6044c040
y.create.l HWIO_BIMC_S_DDR0_DPE_ODT_CONFIG_1_ADDR A:0x6044c044
y.create.l HWIO_BIMC_S_DDR0_DPE_CA_TRAIN_PRE_CS_ADDR A:0x6044c050
y.create.l HWIO_BIMC_S_DDR0_DPE_CA_TRAIN_CS_ADDR A:0x6044c054
y.create.l HWIO_BIMC_S_DDR0_DPE_CA_TRAIN_POST_CS_ADDR A:0x6044c058
y.create.l HWIO_BIMC_S_DDR0_DPE_RCW_CTRL_ADDR A:0x6044c060
y.create.l HWIO_BIMC_S_DDR0_DPE_PWR_CTRL_0_ADDR A:0x6044c068
y.create.l HWIO_BIMC_S_DDR0_DPE_OPT_CTRL_0_ADDR A:0x6044c078
y.create.l HWIO_BIMC_S_DDR0_DPE_OPT_CTRL_1_ADDR A:0x6044c07c
y.create.l HWIO_BIMC_S_DDR0_DPE_DRAM_STATUS_0_ADDR A:0x6044c08c
y.create.l HWIO_BIMC_S_DDR0_DPE_MEMC_STATUS_0_ADDR A:0x6044c09c
y.create.l HWIO_BIMC_S_DDR0_DPE_MEMC_STATUS_1_ADDR A:0x6044c0a0
y.create.l HWIO_BIMC_S_DDR0_DPE_MEMC_STATUS_2_ADDR A:0x6044c0a4
y.create.l HWIO_BIMC_S_DDR0_DPE_INTERRUPT_ENABLE_ADDR A:0x6044c0b4
y.create.l HWIO_BIMC_S_DDR0_DPE_INTERRUPT_STATUS_ADDR A:0x6044c0b8
y.create.l HWIO_BIMC_S_DDR0_DPE_INTERRUPT_CLR_ADDR A:0x6044c0bc
y.create.l HWIO_BIMC_S_DDR0_DPE_INTERRUPT_SET_ADDR A:0x6044c0c0
y.create.l HWIO_BIMC_S_DDR0_DPE_ELEVATE_PRI_RD_ADDR A:0x6044c0d0
y.create.l HWIO_BIMC_S_DDR0_DPE_ELEVATE_PRI_WR_ADDR A:0x6044c0d4
y.create.l HWIO_BIMC_S_DDR0_DPE_TIMER_0_ADDR A:0x6044c0e4
y.create.l HWIO_BIMC_S_DDR0_DPE_TIMER_1_ADDR A:0x6044c0e8
y.create.l HWIO_BIMC_S_DDR0_DPE_TIMER_2_ADDR A:0x6044c0ec
y.create.l HWIO_BIMC_S_DDR0_DPE_TIMER_3_ADDR A:0x6044c0f0
y.create.l HWIO_BIMC_S_DDR0_DPE_MRW_BEFORE_FREQ_SWITCH_0_ADDR A:0x6044c114
y.create.l HWIO_BIMC_S_DDR0_DPE_MRW_BEFORE_FREQ_SWITCH_1_ADDR A:0x6044c118
y.create.l HWIO_BIMC_S_DDR0_DPE_MRW_BEFORE_FREQ_SWITCH_2_ADDR A:0x6044c11c
y.create.l HWIO_BIMC_S_DDR0_DPE_MRW_BEFORE_FREQ_SWITCH_3_ADDR A:0x6044c120
y.create.l HWIO_BIMC_S_DDR0_DPE_MRW_AFTER_FREQ_SWITCH_0_ADDR A:0x6044c124
y.create.l HWIO_BIMC_S_DDR0_DPE_MRW_AFTER_FREQ_SWITCH_1_ADDR A:0x6044c128
y.create.l HWIO_BIMC_S_DDR0_DPE_MRW_AFTER_FREQ_SWITCH_2_ADDR A:0x6044c12c
y.create.l HWIO_BIMC_S_DDR0_DPE_MRW_AFTER_FREQ_SWITCH_3_ADDR A:0x6044c130
y.create.l HWIO_BIMC_S_DDR0_DPE_MRW_FREQ_SWITCH_ADDR A:0x6044c134
y.create.l HWIO_BIMC_S_DDR0_DPE_DRAM_TIMING_0_ADDR A:0x6044c144
y.create.l HWIO_BIMC_S_DDR0_DPE_DRAM_TIMING_1_ADDR A:0x6044c148
y.create.l HWIO_BIMC_S_DDR0_DPE_DRAM_TIMING_2_ADDR A:0x6044c14c
y.create.l HWIO_BIMC_S_DDR0_DPE_DRAM_TIMING_3_ADDR A:0x6044c150
y.create.l HWIO_BIMC_S_DDR0_DPE_DRAM_TIMING_4_ADDR A:0x6044c154
y.create.l HWIO_BIMC_S_DDR0_DPE_DRAM_TIMING_5_ADDR A:0x6044c158
y.create.l HWIO_BIMC_S_DDR0_DPE_DRAM_TIMING_6_ADDR A:0x6044c15c
y.create.l HWIO_BIMC_S_DDR0_DPE_DRAM_TIMING_7_ADDR A:0x6044c160
y.create.l HWIO_BIMC_S_DDR0_DPE_DRAM_TIMING_8_ADDR A:0x6044c164
y.create.l HWIO_BIMC_S_DDR0_DPE_DRAM_TIMING_9_ADDR A:0x6044c168
y.create.l HWIO_BIMC_S_DDR0_DPE_DRAM_TIMING_10_ADDR A:0x6044c16c
y.create.l HWIO_BIMC_S_DDR0_DPE_DRAM_TIMING_11_ADDR A:0x6044c170
y.create.l HWIO_BIMC_S_DDR0_DPE_DRAM_TIMING_12_ADDR A:0x6044c174
y.create.l HWIO_BIMC_S_DDR0_DPE_DRAM_TIMING_13_ADDR A:0x6044c178
y.create.l HWIO_BIMC_S_DDR0_DPE_DRAM_TIMING_14_ADDR A:0x6044c17c
y.create.l HWIO_BIMC_S_DDR0_DPE_DRAM_TIMING_15_ADDR A:0x6044c180
y.create.l HWIO_BIMC_S_DDR0_DPE_DRAM_TIMING_16_ADDR A:0x6044c184
y.create.l HWIO_BIMC_S_DDR0_DPE_DRAM_TIMING_17_ADDR A:0x6044c188
y.create.l HWIO_BIMC_S_DDR0_DPE_DRAM_TIMING_18_ADDR A:0x6044c18c
y.create.l HWIO_BIMC_S_DDR0_DPE_DRAM_TIMING_19_ADDR A:0x6044c190
y.create.l HWIO_BIMC_S_DDR0_DPE_DRAM_TIMING_20_ADDR A:0x6044c194
y.create.l HWIO_BIMC_S_DDR0_DPE_DRAM_TIMING_21_ADDR A:0x6044c198
y.create.l HWIO_BIMC_S_DDR0_DPE_DRAM_TIMING_22_ADDR A:0x6044c19c
y.create.l HWIO_BIMC_S_DDR0_DPE_DRAM_TIMING_23_ADDR A:0x6044c1a0
y.create.l HWIO_BIMC_S_DDR0_DPE_DRAM_TIMING_0_ACT_ADDR A:0x6044c1a4
y.create.l HWIO_BIMC_S_DDR0_DPE_DRAM_TIMING_1_ACT_ADDR A:0x6044c1a8
y.create.l HWIO_BIMC_S_DDR0_DPE_DRAM_TIMING_2_ACT_ADDR A:0x6044c1ac
y.create.l HWIO_BIMC_S_DDR0_DPE_DRAM_TIMING_3_ACT_ADDR A:0x6044c1b0
y.create.l HWIO_BIMC_S_DDR0_DPE_DRAM_TIMING_4_ACT_ADDR A:0x6044c1b4
y.create.l HWIO_BIMC_S_DDR0_DPE_DRAM_TIMING_5_ACT_ADDR A:0x6044c1b8
y.create.l HWIO_BIMC_S_DDR0_DPE_DRAM_TIMING_6_ACT_ADDR A:0x6044c1bc
y.create.l HWIO_BIMC_S_DDR0_DPE_DRAM_TIMING_7_ACT_ADDR A:0x6044c1c0
y.create.l HWIO_BIMC_S_DDR0_DPE_DRAM_TIMING_8_ACT_ADDR A:0x6044c1c4
y.create.l HWIO_BIMC_S_DDR0_DPE_DRAM_TIMING_9_ACT_ADDR A:0x6044c1c8
y.create.l HWIO_BIMC_S_DDR0_DPE_DRAM_TIMING_10_ACT_ADDR A:0x6044c1cc
y.create.l HWIO_BIMC_S_DDR0_DPE_DRAM_TIMING_11_ACT_ADDR A:0x6044c1d0
y.create.l HWIO_BIMC_S_DDR0_DPE_DRAM_TIMING_12_ACT_ADDR A:0x6044c1d4
y.create.l HWIO_BIMC_S_DDR0_DPE_DRAM_TIMING_13_ACT_ADDR A:0x6044c1d8
y.create.l HWIO_BIMC_S_DDR0_DPE_DRAM_TIMING_14_ACT_ADDR A:0x6044c1dc
y.create.l HWIO_BIMC_S_DDR0_DPE_DRAM_TIMING_15_ACT_ADDR A:0x6044c1e0
y.create.l HWIO_BIMC_S_DDR0_DPE_DRAM_TIMING_16_ACT_ADDR A:0x6044c1e4
y.create.l HWIO_BIMC_S_DDR0_DPE_DRAM_TIMING_17_ACT_ADDR A:0x6044c1e8
y.create.l HWIO_BIMC_S_DDR0_DPE_DRAM_TIMING_18_ACT_ADDR A:0x6044c1ec
y.create.l HWIO_BIMC_S_DDR0_DPE_DRAM_TIMING_19_ACT_ADDR A:0x6044c1f0
y.create.l HWIO_BIMC_S_DDR0_DPE_DRAM_TIMING_20_ACT_ADDR A:0x6044c1f4
y.create.l HWIO_BIMC_S_DDR0_DPE_DRAM_TIMING_21_ACT_ADDR A:0x6044c1f8
y.create.l HWIO_BIMC_S_DDR0_DPE_DRAM_TIMING_22_ACT_ADDR A:0x6044c1fc
y.create.l HWIO_BIMC_S_DDR0_DPE_DRAM_TIMING_23_ACT_ADDR A:0x6044c200
y.create.l HWIO_BIMC_S_DDR0_DPE_TESTBUS_CTRL_ADDR A:0x6044c204
y.create.l HWIO_BIMC_S_DDR0_DPE_SPARE_REG_ADDR A:0x6044c214
y.create.l HWIO_BIMC_S_DDR0_DPE_SPARE_REG_ACT_ADDR A:0x6044c224
y.create.l HWIO_BIMC_S_DDR0_DPE_DQCAL_RDATA_RANK1_U_ADDR A:0x6044c240
y.create.l HWIO_BIMC_S_DDR0_DPE_DQCAL_RDATA_RANK1_L_ADDR A:0x6044c244
y.create.l HWIO_BIMC_S_DDR0_DPE_DQCAL_RDATA_RANK0_U_ADDR A:0x6044c248
y.create.l HWIO_BIMC_S_DDR0_DPE_DQCAL_RDATA_RANK0_L_ADDR A:0x6044c24c
y.create.l HWIO_BIMC_S_DDR0_DPE_DQCAL_STATUS0_RANK1_ADDR A:0x6044c260
y.create.l HWIO_BIMC_S_DDR0_DPE_DQCAL_STATUS1_RANK1_ADDR A:0x6044c264
y.create.l HWIO_BIMC_S_DDR0_DPE_DQCAL_STATUS2_RANK1_ADDR A:0x6044c268
y.create.l HWIO_BIMC_S_DDR0_DPE_DQCAL_STATUS0_RANK0_ADDR A:0x6044c280
y.create.l HWIO_BIMC_S_DDR0_DPE_DQCAL_STATUS1_RANK0_ADDR A:0x6044c284
y.create.l HWIO_BIMC_S_DDR0_DPE_DQCAL_STATUS2_RANK0_ADDR A:0x6044c288
y.create.l HWIO_BIMC_S_DDR0_DPE_CGC_CTRL_ADDR A:0x6044c2fc
y.create.l HWIO_BIMC_S_DDR0_DPE_PMON_EN_ADDR A:0x6044c300
y.create.l HWIO_BIMC_S_DDR0_DPE_PMON_CFG_ADDR A:0x6044c304
y.create.l HWIO_BIMC_S_DDR0_DPE_PMON_CMD_QUEUED_0_ADDR A:0x6044c310
y.create.l HWIO_BIMC_S_DDR0_DPE_PMON_CMD_QUEUED_1_ADDR A:0x6044c314
y.create.l HWIO_BIMC_S_DDR0_DPE_PMON_CMD_QUEUED_2_ADDR A:0x6044c318
y.create.l HWIO_BIMC_S_DDR0_DPE_PMON_CMD_QUEUED_3_ADDR A:0x6044c31c
y.create.l HWIO_BIMC_S_DDR0_DPE_PMON_CMD_EXEC_0_ADDR A:0x6044c320
y.create.l HWIO_BIMC_S_DDR0_DPE_PMON_CMD_EXEC_1_ADDR A:0x6044c324
y.create.l HWIO_BIMC_S_DDR0_DPE_PMON_CMD_EXEC_2_ADDR A:0x6044c328
y.create.l HWIO_BIMC_S_DDR0_DPE_PMON_CMD_EXEC_3_ADDR A:0x6044c32c
y.create.l HWIO_BIMC_S_DDR0_DPE_PMON_CMD_FLTR_0_ADDR A:0x6044c330
y.create.l HWIO_BIMC_S_DDR0_DPE_PMON_CMD_FLTR_1_ADDR A:0x6044c334
y.create.l HWIO_BIMC_S_DDR0_DPE_PMON_CMD_FLTR_2_ADDR A:0x6044c338
y.create.l HWIO_BIMC_S_DDR0_DPE_PMON_CMD_FLTR_3_ADDR A:0x6044c33c
y.create.l HWIO_BIMC_S_DDR0_DPE_PMON_ADDR_FLTR_0_ADDR A:0x6044c340
y.create.l HWIO_BIMC_S_DDR0_DPE_PMON_ADDR_FLTR_1_ADDR A:0x6044c344
y.create.l HWIO_BIMC_S_DDR0_DPE_PMON_ADDR_FLTR_2_ADDR A:0x6044c348
y.create.l HWIO_BIMC_S_DDR0_DPE_PMON_ADDR_FLTR_3_ADDR A:0x6044c34c
y.create.l HWIO_BIMC_S_DDR0_DPE_PMON_MID_FLTR_0_ADDR A:0x6044c350
y.create.l HWIO_BIMC_S_DDR0_DPE_PMON_MID_FLTR_1_ADDR A:0x6044c354
y.create.l HWIO_BIMC_S_DDR0_DPE_PMON_LAT_LIM_0_ADDR A:0x6044c360
y.create.l HWIO_BIMC_S_DDR0_DPE_PMON_LAT_LIM_1_ADDR A:0x6044c364
y.create.l HWIO_BIMC_S_DDR0_DPE_PMON_LAT_LIM_2_ADDR A:0x6044c368
y.create.l HWIO_BIMC_S_DDR0_DPE_PMON_LAT_LIM_3_ADDR A:0x6044c36c
y.create.l HWIO_BIMC_S_DDR0_DPE_PMON_PRI_FLTR_0_ADDR A:0x6044c370
y.create.l HWIO_BIMC_S_DDR0_DPE_PMON_PRI_FLTR_1_ADDR A:0x6044c374
y.create.l HWIO_BIMC_S_DDR0_DPE_PMON_PRI_FLTR_2_ADDR A:0x6044c378
y.create.l HWIO_BIMC_S_DDR0_DPE_PMON_PRI_FLTR_3_ADDR A:0x6044c37c
y.create.l HWIO_BIMC_S_DDR0_DPE_PMON_CMDQ_0_ADDR A:0x6044c380
y.create.l HWIO_BIMC_S_DDR0_DPE_PMON_CMDQ_1_ADDR A:0x6044c384
y.create.l HWIO_BIMC_S_DDR0_DPE_PMON_WRBUF_0_ADDR A:0x6044c388
y.create.l HWIO_BIMC_S_DDR0_DPE_PMON_WRBUF_1_ADDR A:0x6044c38c
y.create.l HWIO_BIMC_S_DDR0_DPE_PMON_DDR_CMD_0_ADDR A:0x6044c390
y.create.l HWIO_BIMC_S_DDR0_DPE_PMON_DDR_CMD_1_ADDR A:0x6044c394
y.create.l HWIO_BIMC_S_DDR0_DPE_PMON_DDR_CMD_2_ADDR A:0x6044c398
y.create.l HWIO_BIMC_S_DDR0_DPE_PMON_DDR_CMD_3_ADDR A:0x6044c39c
y.create.l HWIO_BIMC_S_DDR0_DPE_PMON_DDR_DATA_0_ADDR A:0x6044c3a0
y.create.l HWIO_BIMC_S_DDR0_DPE_PMON_DDR_DATA_1_ADDR A:0x6044c3a4
y.create.l HWIO_BIMC_S_DDR0_DPE_PMON_RANK_STATE_0_ADDR A:0x6044c3b0
y.create.l HWIO_BIMC_S_DDR0_DPE_PMON_RANK_STATE_1_ADDR A:0x6044c3b4
y.create.l HWIO_BIMC_S_DDR0_DPE_PMON_RANK_STATE_2_ADDR A:0x6044c3b8
y.create.l HWIO_BIMC_S_DDR0_DPE_PMON_RANK_STATE_3_ADDR A:0x6044c3bc
y.create.l HWIO_BIMC_S_DDR0_DPE_PMON_SHKE_0_ADDR A:0x6044c3c0
y.create.l HWIO_BIMC_S_DDR0_DPE_PMON_SHKE_1_ADDR A:0x6044c3c4
y.create.l HWIO_BIMC_S_DDR0_DPE_PMON_SHKE_2_ADDR A:0x6044c3c8
y.create.l HWIO_BIMC_S_DDR0_DPE_PMON_SHKE_3_ADDR A:0x6044c3cc
y.create.l HWIO_BIMC_S_DDR0_DPE_PMON_SHKE_4_ADDR A:0x6044c3d0
y.create.l HWIO_BIMC_S_DDR0_DPE_PMON_SHKE_5_ADDR A:0x6044c3d4
y.create.l HWIO_BIMC_S_DDR0_DPE_PMON_SHKE_6_ADDR A:0x6044c3d8
y.create.l HWIO_BIMC_S_DDR0_DPE_PMON_SHKE_7_ADDR A:0x6044c3dc
y.create.l HWIO_BIMC_S_DDR0_SHKE_HW_INFO_ADDR A:0x6044d000
y.create.l HWIO_BIMC_S_DDR0_SHKE_CONFIG_ADDR A:0x6044d004
y.create.l HWIO_BIMC_S_DDR0_SHKE_CGC_CNTL_ADDR A:0x6044d010
y.create.l HWIO_BIMC_S_DDR0_SHKE_DRAM_MANUAL_0_ADDR A:0x6044d020
y.create.l HWIO_BIMC_S_DDR0_SHKE_DRAM_MANUAL_1_ADDR A:0x6044d024
y.create.l HWIO_BIMC_S_DDR0_SHKE_MREG_ADDR_WDATA_CNTL_ADDR A:0x6044d030
y.create.l HWIO_BIMC_S_DDR0_SHKE_MREG_RDATA_RANK1_U_ADDR A:0x6044d050
y.create.l HWIO_BIMC_S_DDR0_SHKE_MREG_RDATA_RANK1_L_ADDR A:0x6044d054
y.create.l HWIO_BIMC_S_DDR0_SHKE_MREG_RDATA_RANK0_U_ADDR A:0x6044d060
y.create.l HWIO_BIMC_S_DDR0_SHKE_MREG_RDATA_RANK0_L_ADDR A:0x6044d064
y.create.l HWIO_BIMC_S_DDR0_SHKE_MREG_RDATA_STATUS_ADDR A:0x6044d070
y.create.l HWIO_BIMC_S_DDR0_SHKE_DRAM_STATUS_ADDR A:0x6044d074
y.create.l HWIO_BIMC_S_DDR0_SHKE_DRAM_DEBUG_CMD_0_ADDR A:0x6044d080
y.create.l HWIO_BIMC_S_DDR0_SHKE_DRAM_DEBUG_CMD_1_ADDR A:0x6044d084
y.create.l HWIO_BIMC_S_DDR0_SHKE_DRAM_DEBUG_CMD_2_ADDR A:0x6044d088
y.create.l HWIO_BIMC_S_DDR0_SHKE_PERIODIC_MRR_ADDR A:0x6044d0a0
y.create.l HWIO_BIMC_S_DDR0_SHKE_PERIODIC_MRR_RDATA_RANK1_U_ADDR A:0x6044d0b0
y.create.l HWIO_BIMC_S_DDR0_SHKE_PERIODIC_MRR_RDATA_RANK1_L_ADDR A:0x6044d0b4
y.create.l HWIO_BIMC_S_DDR0_SHKE_PERIODIC_MRR_RDATA_RANK0_U_ADDR A:0x6044d0b8
y.create.l HWIO_BIMC_S_DDR0_SHKE_PERIODIC_MRR_RDATA_RANK0_L_ADDR A:0x6044d0bc
y.create.l HWIO_BIMC_S_DDR0_SHKE_PERIODIC_ZQCAL_ADDR A:0x6044d0d0
y.create.l HWIO_BIMC_S_DDR0_SHKE_AUTO_REFRESH_CNTL_ADDR A:0x6044d0f0
y.create.l HWIO_BIMC_S_DDR0_SHKE_SELF_REFRESH_CNTL_ADDR A:0x6044d0f4
y.create.l HWIO_BIMC_S_DDR0_SHKE_AUTO_REFRESH_CNTL_1_ADDR A:0x6044d100
y.create.l HWIO_BIMC_S_DDR0_SHKE_AUTO_REFRESH_CNTL_2_ADDR A:0x6044d104
y.create.l HWIO_BIMC_S_DDR0_SHKE_TESTBUS_CNTL_ADDR A:0x6044d114
y.create.l HWIO_BIMC_S_DDR0_SHKE_SPARE_REG_ADDR A:0x6044d130
y.create.l HWIO_BLSP_BAM_BAM_CTRL_ADDR A:0x67884000
y.create.l HWIO_BLSP_BAM_BAM_TIMER_ADDR A:0x67884040
y.create.l HWIO_BLSP_BAM_BAM_TIMER_CTRL_ADDR A:0x67884044
y.create.l HWIO_BLSP_BAM_BAM_DESC_CNT_TRSHLD_ADDR A:0x67884008
y.create.l HWIO_BLSP_BAM_BAM_IRQ_STTS_ADDR A:0x67884014
y.create.l HWIO_BLSP_BAM_BAM_IRQ_CLR_ADDR A:0x67884018
y.create.l HWIO_BLSP_BAM_BAM_IRQ_EN_ADDR A:0x6788401c
y.create.l HWIO_BLSP_BAM_BAM_CNFG_BITS_ADDR A:0x6788407c
y.create.l HWIO_BLSP_BAM_BAM_CNFG_BITS_2_ADDR A:0x67884084
y.create.l HWIO_BLSP_BAM_BAM_REVISION_ADDR A:0x67885000
y.create.l HWIO_BLSP_BAM_BAM_SW_VERSION_ADDR A:0x67885004
y.create.l HWIO_BLSP_BAM_BAM_NUM_PIPES_ADDR A:0x67885008
y.create.l HWIO_BLSP_BAM_BAM_TEST_BUS_SEL_ADDR A:0x67885010
y.create.l HWIO_BLSP_BAM_BAM_TEST_BUS_REG_ADDR A:0x67885014
y.create.l HWIO_BLSP_BAM_BAM_AHB_MASTER_ERR_CTRLS_ADDR A:0x67885024
y.create.l HWIO_BLSP_BAM_BAM_AHB_MASTER_ERR_ADDR_ADDR A:0x67885028
y.create.l HWIO_BLSP_BAM_BAM_AHB_MASTER_ERR_DATA_ADDR A:0x6788502c
y.create.l HWIO_BLSP_BAM_BAM_AHB_MASTER_ERR_ADDR_LSB_ADDR A:0x67885100
y.create.l HWIO_BLSP_BAM_BAM_AHB_MASTER_ERR_ADDR_MSB_ADDR A:0x67885104
y.create.l HWIO_BLSP_BAM_BAM_TRUST_REG_ADDR A:0x67886000
y.create.l HWIO_BLSP_BAM_BAM_P_TRUST_REG0_ADDR A:0x67886020
y.create.l HWIO_BLSP_BAM_BAM_P_TRUST_REG1_ADDR A:0x67886024
y.create.l HWIO_BLSP_BAM_BAM_P_TRUST_REG2_ADDR A:0x67886028
y.create.l HWIO_BLSP_BAM_BAM_P_TRUST_REG3_ADDR A:0x6788602c
y.create.l HWIO_BLSP_BAM_BAM_P_TRUST_REG4_ADDR A:0x67886030
y.create.l HWIO_BLSP_BAM_BAM_P_TRUST_REG5_ADDR A:0x67886034
y.create.l HWIO_BLSP_BAM_BAM_P_TRUST_REG6_ADDR A:0x67886038
y.create.l HWIO_BLSP_BAM_BAM_P_TRUST_REG7_ADDR A:0x6788603c
y.create.l HWIO_BLSP_BAM_BAM_P_TRUST_REG8_ADDR A:0x67886040
y.create.l HWIO_BLSP_BAM_BAM_P_TRUST_REG9_ADDR A:0x67886044
y.create.l HWIO_BLSP_BAM_BAM_IRQ_SRCS_EE0_ADDR A:0x67887000
y.create.l HWIO_BLSP_BAM_BAM_IRQ_SRCS_EE1_ADDR A:0x67888000
y.create.l HWIO_BLSP_BAM_BAM_IRQ_SRCS_EE2_ADDR A:0x67889000
y.create.l HWIO_BLSP_BAM_BAM_IRQ_SRCS_EE3_ADDR A:0x6788a000
y.create.l HWIO_BLSP_BAM_BAM_IRQ_SRCS_EE4_ADDR A:0x6788b000
y.create.l HWIO_BLSP_BAM_BAM_IRQ_SRCS_EE5_ADDR A:0x6788c000
y.create.l HWIO_BLSP_BAM_BAM_IRQ_SRCS_EE6_ADDR A:0x6788d000
y.create.l HWIO_BLSP_BAM_BAM_IRQ_SRCS_EE7_ADDR A:0x6788e000
y.create.l HWIO_BLSP_BAM_BAM_IRQ_SRCS_MSK_EE0_ADDR A:0x67887004
y.create.l HWIO_BLSP_BAM_BAM_IRQ_SRCS_MSK_EE1_ADDR A:0x67888004
y.create.l HWIO_BLSP_BAM_BAM_IRQ_SRCS_MSK_EE2_ADDR A:0x67889004
y.create.l HWIO_BLSP_BAM_BAM_IRQ_SRCS_MSK_EE3_ADDR A:0x6788a004
y.create.l HWIO_BLSP_BAM_BAM_IRQ_SRCS_MSK_EE4_ADDR A:0x6788b004
y.create.l HWIO_BLSP_BAM_BAM_IRQ_SRCS_MSK_EE5_ADDR A:0x6788c004
y.create.l HWIO_BLSP_BAM_BAM_IRQ_SRCS_MSK_EE6_ADDR A:0x6788d004
y.create.l HWIO_BLSP_BAM_BAM_IRQ_SRCS_MSK_EE7_ADDR A:0x6788e004
y.create.l HWIO_BLSP_BAM_BAM_IRQ_SRCS_UNMASKED_EE0_ADDR A:0x67887008
y.create.l HWIO_BLSP_BAM_BAM_IRQ_SRCS_UNMASKED_EE1_ADDR A:0x67888008
y.create.l HWIO_BLSP_BAM_BAM_IRQ_SRCS_UNMASKED_EE2_ADDR A:0x67889008
y.create.l HWIO_BLSP_BAM_BAM_IRQ_SRCS_UNMASKED_EE3_ADDR A:0x6788a008
y.create.l HWIO_BLSP_BAM_BAM_IRQ_SRCS_UNMASKED_EE4_ADDR A:0x6788b008
y.create.l HWIO_BLSP_BAM_BAM_IRQ_SRCS_UNMASKED_EE5_ADDR A:0x6788c008
y.create.l HWIO_BLSP_BAM_BAM_IRQ_SRCS_UNMASKED_EE6_ADDR A:0x6788d008
y.create.l HWIO_BLSP_BAM_BAM_IRQ_SRCS_UNMASKED_EE7_ADDR A:0x6788e008
y.create.l HWIO_BLSP_BAM_BAM_PIPE_ATTR_EE0_ADDR A:0x6788700c
y.create.l HWIO_BLSP_BAM_BAM_PIPE_ATTR_EE1_ADDR A:0x6788800c
y.create.l HWIO_BLSP_BAM_BAM_PIPE_ATTR_EE2_ADDR A:0x6788900c
y.create.l HWIO_BLSP_BAM_BAM_PIPE_ATTR_EE3_ADDR A:0x6788a00c
y.create.l HWIO_BLSP_BAM_BAM_PIPE_ATTR_EE4_ADDR A:0x6788b00c
y.create.l HWIO_BLSP_BAM_BAM_PIPE_ATTR_EE5_ADDR A:0x6788c00c
y.create.l HWIO_BLSP_BAM_BAM_PIPE_ATTR_EE6_ADDR A:0x6788d00c
y.create.l HWIO_BLSP_BAM_BAM_PIPE_ATTR_EE7_ADDR A:0x6788e00c
y.create.l HWIO_BLSP_BAM_BAM_IRQ_SRCS_ADDR A:0x67887010
y.create.l HWIO_BLSP_BAM_BAM_IRQ_SRCS_MSK_ADDR A:0x67887014
y.create.l HWIO_BLSP_BAM_BAM_IRQ_SRCS_UNMASKED_ADDR A:0x67887018
y.create.l HWIO_BLSP_BAM_BAM_P_CTRL0_ADDR A:0x67897000
y.create.l HWIO_BLSP_BAM_BAM_P_CTRL1_ADDR A:0x67898000
y.create.l HWIO_BLSP_BAM_BAM_P_CTRL2_ADDR A:0x67899000
y.create.l HWIO_BLSP_BAM_BAM_P_CTRL3_ADDR A:0x6789a000
y.create.l HWIO_BLSP_BAM_BAM_P_CTRL4_ADDR A:0x6789b000
y.create.l HWIO_BLSP_BAM_BAM_P_CTRL5_ADDR A:0x6789c000
y.create.l HWIO_BLSP_BAM_BAM_P_CTRL6_ADDR A:0x6789d000
y.create.l HWIO_BLSP_BAM_BAM_P_CTRL7_ADDR A:0x6789e000
y.create.l HWIO_BLSP_BAM_BAM_P_CTRL8_ADDR A:0x6789f000
y.create.l HWIO_BLSP_BAM_BAM_P_CTRL9_ADDR A:0x678a0000
y.create.l HWIO_BLSP_BAM_BAM_P_RST0_ADDR A:0x67897004
y.create.l HWIO_BLSP_BAM_BAM_P_RST1_ADDR A:0x67898004
y.create.l HWIO_BLSP_BAM_BAM_P_RST2_ADDR A:0x67899004
y.create.l HWIO_BLSP_BAM_BAM_P_RST3_ADDR A:0x6789a004
y.create.l HWIO_BLSP_BAM_BAM_P_RST4_ADDR A:0x6789b004
y.create.l HWIO_BLSP_BAM_BAM_P_RST5_ADDR A:0x6789c004
y.create.l HWIO_BLSP_BAM_BAM_P_RST6_ADDR A:0x6789d004
y.create.l HWIO_BLSP_BAM_BAM_P_RST7_ADDR A:0x6789e004
y.create.l HWIO_BLSP_BAM_BAM_P_RST8_ADDR A:0x6789f004
y.create.l HWIO_BLSP_BAM_BAM_P_RST9_ADDR A:0x678a0004
y.create.l HWIO_BLSP_BAM_BAM_P_HALT0_ADDR A:0x67897008
y.create.l HWIO_BLSP_BAM_BAM_P_HALT1_ADDR A:0x67898008
y.create.l HWIO_BLSP_BAM_BAM_P_HALT2_ADDR A:0x67899008
y.create.l HWIO_BLSP_BAM_BAM_P_HALT3_ADDR A:0x6789a008
y.create.l HWIO_BLSP_BAM_BAM_P_HALT4_ADDR A:0x6789b008
y.create.l HWIO_BLSP_BAM_BAM_P_HALT5_ADDR A:0x6789c008
y.create.l HWIO_BLSP_BAM_BAM_P_HALT6_ADDR A:0x6789d008
y.create.l HWIO_BLSP_BAM_BAM_P_HALT7_ADDR A:0x6789e008
y.create.l HWIO_BLSP_BAM_BAM_P_HALT8_ADDR A:0x6789f008
y.create.l HWIO_BLSP_BAM_BAM_P_HALT9_ADDR A:0x678a0008
y.create.l HWIO_BLSP_BAM_BAM_P_IRQ_STTS0_ADDR A:0x67897010
y.create.l HWIO_BLSP_BAM_BAM_P_IRQ_STTS1_ADDR A:0x67898010
y.create.l HWIO_BLSP_BAM_BAM_P_IRQ_STTS2_ADDR A:0x67899010
y.create.l HWIO_BLSP_BAM_BAM_P_IRQ_STTS3_ADDR A:0x6789a010
y.create.l HWIO_BLSP_BAM_BAM_P_IRQ_STTS4_ADDR A:0x6789b010
y.create.l HWIO_BLSP_BAM_BAM_P_IRQ_STTS5_ADDR A:0x6789c010
y.create.l HWIO_BLSP_BAM_BAM_P_IRQ_STTS6_ADDR A:0x6789d010
y.create.l HWIO_BLSP_BAM_BAM_P_IRQ_STTS7_ADDR A:0x6789e010
y.create.l HWIO_BLSP_BAM_BAM_P_IRQ_STTS8_ADDR A:0x6789f010
y.create.l HWIO_BLSP_BAM_BAM_P_IRQ_STTS9_ADDR A:0x678a0010
y.create.l HWIO_BLSP_BAM_BAM_P_IRQ_CLR0_ADDR A:0x67897014
y.create.l HWIO_BLSP_BAM_BAM_P_IRQ_CLR1_ADDR A:0x67898014
y.create.l HWIO_BLSP_BAM_BAM_P_IRQ_CLR2_ADDR A:0x67899014
y.create.l HWIO_BLSP_BAM_BAM_P_IRQ_CLR3_ADDR A:0x6789a014
y.create.l HWIO_BLSP_BAM_BAM_P_IRQ_CLR4_ADDR A:0x6789b014
y.create.l HWIO_BLSP_BAM_BAM_P_IRQ_CLR5_ADDR A:0x6789c014
y.create.l HWIO_BLSP_BAM_BAM_P_IRQ_CLR6_ADDR A:0x6789d014
y.create.l HWIO_BLSP_BAM_BAM_P_IRQ_CLR7_ADDR A:0x6789e014
y.create.l HWIO_BLSP_BAM_BAM_P_IRQ_CLR8_ADDR A:0x6789f014
y.create.l HWIO_BLSP_BAM_BAM_P_IRQ_CLR9_ADDR A:0x678a0014
y.create.l HWIO_BLSP_BAM_BAM_P_IRQ_EN0_ADDR A:0x67897018
y.create.l HWIO_BLSP_BAM_BAM_P_IRQ_EN1_ADDR A:0x67898018
y.create.l HWIO_BLSP_BAM_BAM_P_IRQ_EN2_ADDR A:0x67899018
y.create.l HWIO_BLSP_BAM_BAM_P_IRQ_EN3_ADDR A:0x6789a018
y.create.l HWIO_BLSP_BAM_BAM_P_IRQ_EN4_ADDR A:0x6789b018
y.create.l HWIO_BLSP_BAM_BAM_P_IRQ_EN5_ADDR A:0x6789c018
y.create.l HWIO_BLSP_BAM_BAM_P_IRQ_EN6_ADDR A:0x6789d018
y.create.l HWIO_BLSP_BAM_BAM_P_IRQ_EN7_ADDR A:0x6789e018
y.create.l HWIO_BLSP_BAM_BAM_P_IRQ_EN8_ADDR A:0x6789f018
y.create.l HWIO_BLSP_BAM_BAM_P_IRQ_EN9_ADDR A:0x678a0018
y.create.l HWIO_BLSP_BAM_BAM_P_TIMER0_ADDR A:0x6789701c
y.create.l HWIO_BLSP_BAM_BAM_P_TIMER1_ADDR A:0x6789801c
y.create.l HWIO_BLSP_BAM_BAM_P_TIMER2_ADDR A:0x6789901c
y.create.l HWIO_BLSP_BAM_BAM_P_TIMER3_ADDR A:0x6789a01c
y.create.l HWIO_BLSP_BAM_BAM_P_TIMER4_ADDR A:0x6789b01c
y.create.l HWIO_BLSP_BAM_BAM_P_TIMER5_ADDR A:0x6789c01c
y.create.l HWIO_BLSP_BAM_BAM_P_TIMER6_ADDR A:0x6789d01c
y.create.l HWIO_BLSP_BAM_BAM_P_TIMER7_ADDR A:0x6789e01c
y.create.l HWIO_BLSP_BAM_BAM_P_TIMER8_ADDR A:0x6789f01c
y.create.l HWIO_BLSP_BAM_BAM_P_TIMER9_ADDR A:0x678a001c
y.create.l HWIO_BLSP_BAM_BAM_P_TIMER_CTRL0_ADDR A:0x67897020
y.create.l HWIO_BLSP_BAM_BAM_P_TIMER_CTRL1_ADDR A:0x67898020
y.create.l HWIO_BLSP_BAM_BAM_P_TIMER_CTRL2_ADDR A:0x67899020
y.create.l HWIO_BLSP_BAM_BAM_P_TIMER_CTRL3_ADDR A:0x6789a020
y.create.l HWIO_BLSP_BAM_BAM_P_TIMER_CTRL4_ADDR A:0x6789b020
y.create.l HWIO_BLSP_BAM_BAM_P_TIMER_CTRL5_ADDR A:0x6789c020
y.create.l HWIO_BLSP_BAM_BAM_P_TIMER_CTRL6_ADDR A:0x6789d020
y.create.l HWIO_BLSP_BAM_BAM_P_TIMER_CTRL7_ADDR A:0x6789e020
y.create.l HWIO_BLSP_BAM_BAM_P_TIMER_CTRL8_ADDR A:0x6789f020
y.create.l HWIO_BLSP_BAM_BAM_P_TIMER_CTRL9_ADDR A:0x678a0020
y.create.l HWIO_BLSP_BAM_BAM_P_PRDCR_SDBND0_ADDR A:0x67897024
y.create.l HWIO_BLSP_BAM_BAM_P_PRDCR_SDBND1_ADDR A:0x67898024
y.create.l HWIO_BLSP_BAM_BAM_P_PRDCR_SDBND2_ADDR A:0x67899024
y.create.l HWIO_BLSP_BAM_BAM_P_PRDCR_SDBND3_ADDR A:0x6789a024
y.create.l HWIO_BLSP_BAM_BAM_P_PRDCR_SDBND4_ADDR A:0x6789b024
y.create.l HWIO_BLSP_BAM_BAM_P_PRDCR_SDBND5_ADDR A:0x6789c024
y.create.l HWIO_BLSP_BAM_BAM_P_PRDCR_SDBND6_ADDR A:0x6789d024
y.create.l HWIO_BLSP_BAM_BAM_P_PRDCR_SDBND7_ADDR A:0x6789e024
y.create.l HWIO_BLSP_BAM_BAM_P_PRDCR_SDBND8_ADDR A:0x6789f024
y.create.l HWIO_BLSP_BAM_BAM_P_PRDCR_SDBND9_ADDR A:0x678a0024
y.create.l HWIO_BLSP_BAM_BAM_P_CNSMR_SDBND0_ADDR A:0x67897028
y.create.l HWIO_BLSP_BAM_BAM_P_CNSMR_SDBND1_ADDR A:0x67898028
y.create.l HWIO_BLSP_BAM_BAM_P_CNSMR_SDBND2_ADDR A:0x67899028
y.create.l HWIO_BLSP_BAM_BAM_P_CNSMR_SDBND3_ADDR A:0x6789a028
y.create.l HWIO_BLSP_BAM_BAM_P_CNSMR_SDBND4_ADDR A:0x6789b028
y.create.l HWIO_BLSP_BAM_BAM_P_CNSMR_SDBND5_ADDR A:0x6789c028
y.create.l HWIO_BLSP_BAM_BAM_P_CNSMR_SDBND6_ADDR A:0x6789d028
y.create.l HWIO_BLSP_BAM_BAM_P_CNSMR_SDBND7_ADDR A:0x6789e028
y.create.l HWIO_BLSP_BAM_BAM_P_CNSMR_SDBND8_ADDR A:0x6789f028
y.create.l HWIO_BLSP_BAM_BAM_P_CNSMR_SDBND9_ADDR A:0x678a0028
y.create.l HWIO_BLSP_BAM_BAM_P_SW_OFSTS0_ADDR A:0x67897800
y.create.l HWIO_BLSP_BAM_BAM_P_SW_OFSTS1_ADDR A:0x67898800
y.create.l HWIO_BLSP_BAM_BAM_P_SW_OFSTS2_ADDR A:0x67899800
y.create.l HWIO_BLSP_BAM_BAM_P_SW_OFSTS3_ADDR A:0x6789a800
y.create.l HWIO_BLSP_BAM_BAM_P_SW_OFSTS4_ADDR A:0x6789b800
y.create.l HWIO_BLSP_BAM_BAM_P_SW_OFSTS5_ADDR A:0x6789c800
y.create.l HWIO_BLSP_BAM_BAM_P_SW_OFSTS6_ADDR A:0x6789d800
y.create.l HWIO_BLSP_BAM_BAM_P_SW_OFSTS7_ADDR A:0x6789e800
y.create.l HWIO_BLSP_BAM_BAM_P_SW_OFSTS8_ADDR A:0x6789f800
y.create.l HWIO_BLSP_BAM_BAM_P_SW_OFSTS9_ADDR A:0x678a0800
y.create.l HWIO_BLSP_BAM_BAM_P_AU_PSM_CNTXT_1_0_ADDR A:0x67897804
y.create.l HWIO_BLSP_BAM_BAM_P_AU_PSM_CNTXT_1_1_ADDR A:0x67898804
y.create.l HWIO_BLSP_BAM_BAM_P_AU_PSM_CNTXT_1_2_ADDR A:0x67899804
y.create.l HWIO_BLSP_BAM_BAM_P_AU_PSM_CNTXT_1_3_ADDR A:0x6789a804
y.create.l HWIO_BLSP_BAM_BAM_P_AU_PSM_CNTXT_1_4_ADDR A:0x6789b804
y.create.l HWIO_BLSP_BAM_BAM_P_AU_PSM_CNTXT_1_5_ADDR A:0x6789c804
y.create.l HWIO_BLSP_BAM_BAM_P_AU_PSM_CNTXT_1_6_ADDR A:0x6789d804
y.create.l HWIO_BLSP_BAM_BAM_P_AU_PSM_CNTXT_1_7_ADDR A:0x6789e804
y.create.l HWIO_BLSP_BAM_BAM_P_AU_PSM_CNTXT_1_8_ADDR A:0x6789f804
y.create.l HWIO_BLSP_BAM_BAM_P_AU_PSM_CNTXT_1_9_ADDR A:0x678a0804
y.create.l HWIO_BLSP_BAM_BAM_P_PSM_CNTXT_2_0_ADDR A:0x67897808
y.create.l HWIO_BLSP_BAM_BAM_P_PSM_CNTXT_2_1_ADDR A:0x67898808
y.create.l HWIO_BLSP_BAM_BAM_P_PSM_CNTXT_2_2_ADDR A:0x67899808
y.create.l HWIO_BLSP_BAM_BAM_P_PSM_CNTXT_2_3_ADDR A:0x6789a808
y.create.l HWIO_BLSP_BAM_BAM_P_PSM_CNTXT_2_4_ADDR A:0x6789b808
y.create.l HWIO_BLSP_BAM_BAM_P_PSM_CNTXT_2_5_ADDR A:0x6789c808
y.create.l HWIO_BLSP_BAM_BAM_P_PSM_CNTXT_2_6_ADDR A:0x6789d808
y.create.l HWIO_BLSP_BAM_BAM_P_PSM_CNTXT_2_7_ADDR A:0x6789e808
y.create.l HWIO_BLSP_BAM_BAM_P_PSM_CNTXT_2_8_ADDR A:0x6789f808
y.create.l HWIO_BLSP_BAM_BAM_P_PSM_CNTXT_2_9_ADDR A:0x678a0808
y.create.l HWIO_BLSP_BAM_BAM_P_PSM_CNTXT_3_0_ADDR A:0x6789780c
y.create.l HWIO_BLSP_BAM_BAM_P_PSM_CNTXT_3_1_ADDR A:0x6789880c
y.create.l HWIO_BLSP_BAM_BAM_P_PSM_CNTXT_3_2_ADDR A:0x6789980c
y.create.l HWIO_BLSP_BAM_BAM_P_PSM_CNTXT_3_3_ADDR A:0x6789a80c
y.create.l HWIO_BLSP_BAM_BAM_P_PSM_CNTXT_3_4_ADDR A:0x6789b80c
y.create.l HWIO_BLSP_BAM_BAM_P_PSM_CNTXT_3_5_ADDR A:0x6789c80c
y.create.l HWIO_BLSP_BAM_BAM_P_PSM_CNTXT_3_6_ADDR A:0x6789d80c
y.create.l HWIO_BLSP_BAM_BAM_P_PSM_CNTXT_3_7_ADDR A:0x6789e80c
y.create.l HWIO_BLSP_BAM_BAM_P_PSM_CNTXT_3_8_ADDR A:0x6789f80c
y.create.l HWIO_BLSP_BAM_BAM_P_PSM_CNTXT_3_9_ADDR A:0x678a080c
y.create.l HWIO_BLSP_BAM_BAM_P_PSM_CNTXT_4_0_ADDR A:0x67897810
y.create.l HWIO_BLSP_BAM_BAM_P_PSM_CNTXT_4_1_ADDR A:0x67898810
y.create.l HWIO_BLSP_BAM_BAM_P_PSM_CNTXT_4_2_ADDR A:0x67899810
y.create.l HWIO_BLSP_BAM_BAM_P_PSM_CNTXT_4_3_ADDR A:0x6789a810
y.create.l HWIO_BLSP_BAM_BAM_P_PSM_CNTXT_4_4_ADDR A:0x6789b810
y.create.l HWIO_BLSP_BAM_BAM_P_PSM_CNTXT_4_5_ADDR A:0x6789c810
y.create.l HWIO_BLSP_BAM_BAM_P_PSM_CNTXT_4_6_ADDR A:0x6789d810
y.create.l HWIO_BLSP_BAM_BAM_P_PSM_CNTXT_4_7_ADDR A:0x6789e810
y.create.l HWIO_BLSP_BAM_BAM_P_PSM_CNTXT_4_8_ADDR A:0x6789f810
y.create.l HWIO_BLSP_BAM_BAM_P_PSM_CNTXT_4_9_ADDR A:0x678a0810
y.create.l HWIO_BLSP_BAM_BAM_P_PSM_CNTXT_5_0_ADDR A:0x67897814
y.create.l HWIO_BLSP_BAM_BAM_P_PSM_CNTXT_5_1_ADDR A:0x67898814
y.create.l HWIO_BLSP_BAM_BAM_P_PSM_CNTXT_5_2_ADDR A:0x67899814
y.create.l HWIO_BLSP_BAM_BAM_P_PSM_CNTXT_5_3_ADDR A:0x6789a814
y.create.l HWIO_BLSP_BAM_BAM_P_PSM_CNTXT_5_4_ADDR A:0x6789b814
y.create.l HWIO_BLSP_BAM_BAM_P_PSM_CNTXT_5_5_ADDR A:0x6789c814
y.create.l HWIO_BLSP_BAM_BAM_P_PSM_CNTXT_5_6_ADDR A:0x6789d814
y.create.l HWIO_BLSP_BAM_BAM_P_PSM_CNTXT_5_7_ADDR A:0x6789e814
y.create.l HWIO_BLSP_BAM_BAM_P_PSM_CNTXT_5_8_ADDR A:0x6789f814
y.create.l HWIO_BLSP_BAM_BAM_P_PSM_CNTXT_5_9_ADDR A:0x678a0814
y.create.l HWIO_BLSP_BAM_BAM_P_EVNT_REG0_ADDR A:0x67897818
y.create.l HWIO_BLSP_BAM_BAM_P_EVNT_REG1_ADDR A:0x67898818
y.create.l HWIO_BLSP_BAM_BAM_P_EVNT_REG2_ADDR A:0x67899818
y.create.l HWIO_BLSP_BAM_BAM_P_EVNT_REG3_ADDR A:0x6789a818
y.create.l HWIO_BLSP_BAM_BAM_P_EVNT_REG4_ADDR A:0x6789b818
y.create.l HWIO_BLSP_BAM_BAM_P_EVNT_REG5_ADDR A:0x6789c818
y.create.l HWIO_BLSP_BAM_BAM_P_EVNT_REG6_ADDR A:0x6789d818
y.create.l HWIO_BLSP_BAM_BAM_P_EVNT_REG7_ADDR A:0x6789e818
y.create.l HWIO_BLSP_BAM_BAM_P_EVNT_REG8_ADDR A:0x6789f818
y.create.l HWIO_BLSP_BAM_BAM_P_EVNT_REG9_ADDR A:0x678a0818
y.create.l HWIO_BLSP_BAM_BAM_P_DESC_FIFO_ADDR0_ADDR A:0x6789781c
y.create.l HWIO_BLSP_BAM_BAM_P_DESC_FIFO_ADDR1_ADDR A:0x6789881c
y.create.l HWIO_BLSP_BAM_BAM_P_DESC_FIFO_ADDR2_ADDR A:0x6789981c
y.create.l HWIO_BLSP_BAM_BAM_P_DESC_FIFO_ADDR3_ADDR A:0x6789a81c
y.create.l HWIO_BLSP_BAM_BAM_P_DESC_FIFO_ADDR4_ADDR A:0x6789b81c
y.create.l HWIO_BLSP_BAM_BAM_P_DESC_FIFO_ADDR5_ADDR A:0x6789c81c
y.create.l HWIO_BLSP_BAM_BAM_P_DESC_FIFO_ADDR6_ADDR A:0x6789d81c
y.create.l HWIO_BLSP_BAM_BAM_P_DESC_FIFO_ADDR7_ADDR A:0x6789e81c
y.create.l HWIO_BLSP_BAM_BAM_P_DESC_FIFO_ADDR8_ADDR A:0x6789f81c
y.create.l HWIO_BLSP_BAM_BAM_P_DESC_FIFO_ADDR9_ADDR A:0x678a081c
y.create.l HWIO_BLSP_BAM_BAM_P_FIFO_SIZES0_ADDR A:0x67897820
y.create.l HWIO_BLSP_BAM_BAM_P_FIFO_SIZES1_ADDR A:0x67898820
y.create.l HWIO_BLSP_BAM_BAM_P_FIFO_SIZES2_ADDR A:0x67899820
y.create.l HWIO_BLSP_BAM_BAM_P_FIFO_SIZES3_ADDR A:0x6789a820
y.create.l HWIO_BLSP_BAM_BAM_P_FIFO_SIZES4_ADDR A:0x6789b820
y.create.l HWIO_BLSP_BAM_BAM_P_FIFO_SIZES5_ADDR A:0x6789c820
y.create.l HWIO_BLSP_BAM_BAM_P_FIFO_SIZES6_ADDR A:0x6789d820
y.create.l HWIO_BLSP_BAM_BAM_P_FIFO_SIZES7_ADDR A:0x6789e820
y.create.l HWIO_BLSP_BAM_BAM_P_FIFO_SIZES8_ADDR A:0x6789f820
y.create.l HWIO_BLSP_BAM_BAM_P_FIFO_SIZES9_ADDR A:0x678a0820
y.create.l HWIO_BLSP_BAM_BAM_P_DATA_FIFO_ADDR0_ADDR A:0x67897824
y.create.l HWIO_BLSP_BAM_BAM_P_DATA_FIFO_ADDR1_ADDR A:0x67898824
y.create.l HWIO_BLSP_BAM_BAM_P_DATA_FIFO_ADDR2_ADDR A:0x67899824
y.create.l HWIO_BLSP_BAM_BAM_P_DATA_FIFO_ADDR3_ADDR A:0x6789a824
y.create.l HWIO_BLSP_BAM_BAM_P_DATA_FIFO_ADDR4_ADDR A:0x6789b824
y.create.l HWIO_BLSP_BAM_BAM_P_DATA_FIFO_ADDR5_ADDR A:0x6789c824
y.create.l HWIO_BLSP_BAM_BAM_P_DATA_FIFO_ADDR6_ADDR A:0x6789d824
y.create.l HWIO_BLSP_BAM_BAM_P_DATA_FIFO_ADDR7_ADDR A:0x6789e824
y.create.l HWIO_BLSP_BAM_BAM_P_DATA_FIFO_ADDR8_ADDR A:0x6789f824
y.create.l HWIO_BLSP_BAM_BAM_P_DATA_FIFO_ADDR9_ADDR A:0x678a0824
y.create.l HWIO_BLSP_BAM_BAM_P_EVNT_GEN_TRSHLD0_ADDR A:0x67897828
y.create.l HWIO_BLSP_BAM_BAM_P_EVNT_GEN_TRSHLD1_ADDR A:0x67898828
y.create.l HWIO_BLSP_BAM_BAM_P_EVNT_GEN_TRSHLD2_ADDR A:0x67899828
y.create.l HWIO_BLSP_BAM_BAM_P_EVNT_GEN_TRSHLD3_ADDR A:0x6789a828
y.create.l HWIO_BLSP_BAM_BAM_P_EVNT_GEN_TRSHLD4_ADDR A:0x6789b828
y.create.l HWIO_BLSP_BAM_BAM_P_EVNT_GEN_TRSHLD5_ADDR A:0x6789c828
y.create.l HWIO_BLSP_BAM_BAM_P_EVNT_GEN_TRSHLD6_ADDR A:0x6789d828
y.create.l HWIO_BLSP_BAM_BAM_P_EVNT_GEN_TRSHLD7_ADDR A:0x6789e828
y.create.l HWIO_BLSP_BAM_BAM_P_EVNT_GEN_TRSHLD8_ADDR A:0x6789f828
y.create.l HWIO_BLSP_BAM_BAM_P_EVNT_GEN_TRSHLD9_ADDR A:0x678a0828
y.create.l HWIO_BLSP_BAM_BAM_P_EVNT_DEST_ADDR0_ADDR A:0x6789782c
y.create.l HWIO_BLSP_BAM_BAM_P_EVNT_DEST_ADDR1_ADDR A:0x6789882c
y.create.l HWIO_BLSP_BAM_BAM_P_EVNT_DEST_ADDR2_ADDR A:0x6789982c
y.create.l HWIO_BLSP_BAM_BAM_P_EVNT_DEST_ADDR3_ADDR A:0x6789a82c
y.create.l HWIO_BLSP_BAM_BAM_P_EVNT_DEST_ADDR4_ADDR A:0x6789b82c
y.create.l HWIO_BLSP_BAM_BAM_P_EVNT_DEST_ADDR5_ADDR A:0x6789c82c
y.create.l HWIO_BLSP_BAM_BAM_P_EVNT_DEST_ADDR6_ADDR A:0x6789d82c
y.create.l HWIO_BLSP_BAM_BAM_P_EVNT_DEST_ADDR7_ADDR A:0x6789e82c
y.create.l HWIO_BLSP_BAM_BAM_P_EVNT_DEST_ADDR8_ADDR A:0x6789f82c
y.create.l HWIO_BLSP_BAM_BAM_P_EVNT_DEST_ADDR9_ADDR A:0x678a082c
y.create.l HWIO_BLSP_BAM_BAM_P_DF_CNTXT_0_ADDR A:0x67897830
y.create.l HWIO_BLSP_BAM_BAM_P_DF_CNTXT_1_ADDR A:0x67898830
y.create.l HWIO_BLSP_BAM_BAM_P_DF_CNTXT_2_ADDR A:0x67899830
y.create.l HWIO_BLSP_BAM_BAM_P_DF_CNTXT_3_ADDR A:0x6789a830
y.create.l HWIO_BLSP_BAM_BAM_P_DF_CNTXT_4_ADDR A:0x6789b830
y.create.l HWIO_BLSP_BAM_BAM_P_DF_CNTXT_5_ADDR A:0x6789c830
y.create.l HWIO_BLSP_BAM_BAM_P_DF_CNTXT_6_ADDR A:0x6789d830
y.create.l HWIO_BLSP_BAM_BAM_P_DF_CNTXT_7_ADDR A:0x6789e830
y.create.l HWIO_BLSP_BAM_BAM_P_DF_CNTXT_8_ADDR A:0x6789f830
y.create.l HWIO_BLSP_BAM_BAM_P_DF_CNTXT_9_ADDR A:0x678a0830
y.create.l HWIO_BLSP_BAM_BAM_P_RETR_CNTXT_0_ADDR A:0x67897834
y.create.l HWIO_BLSP_BAM_BAM_P_RETR_CNTXT_1_ADDR A:0x67898834
y.create.l HWIO_BLSP_BAM_BAM_P_RETR_CNTXT_2_ADDR A:0x67899834
y.create.l HWIO_BLSP_BAM_BAM_P_RETR_CNTXT_3_ADDR A:0x6789a834
y.create.l HWIO_BLSP_BAM_BAM_P_RETR_CNTXT_4_ADDR A:0x6789b834
y.create.l HWIO_BLSP_BAM_BAM_P_RETR_CNTXT_5_ADDR A:0x6789c834
y.create.l HWIO_BLSP_BAM_BAM_P_RETR_CNTXT_6_ADDR A:0x6789d834
y.create.l HWIO_BLSP_BAM_BAM_P_RETR_CNTXT_7_ADDR A:0x6789e834
y.create.l HWIO_BLSP_BAM_BAM_P_RETR_CNTXT_8_ADDR A:0x6789f834
y.create.l HWIO_BLSP_BAM_BAM_P_RETR_CNTXT_9_ADDR A:0x678a0834
y.create.l HWIO_BLSP_BAM_BAM_P_SI_CNTXT_0_ADDR A:0x67897838
y.create.l HWIO_BLSP_BAM_BAM_P_SI_CNTXT_1_ADDR A:0x67898838
y.create.l HWIO_BLSP_BAM_BAM_P_SI_CNTXT_2_ADDR A:0x67899838
y.create.l HWIO_BLSP_BAM_BAM_P_SI_CNTXT_3_ADDR A:0x6789a838
y.create.l HWIO_BLSP_BAM_BAM_P_SI_CNTXT_4_ADDR A:0x6789b838
y.create.l HWIO_BLSP_BAM_BAM_P_SI_CNTXT_5_ADDR A:0x6789c838
y.create.l HWIO_BLSP_BAM_BAM_P_SI_CNTXT_6_ADDR A:0x6789d838
y.create.l HWIO_BLSP_BAM_BAM_P_SI_CNTXT_7_ADDR A:0x6789e838
y.create.l HWIO_BLSP_BAM_BAM_P_SI_CNTXT_8_ADDR A:0x6789f838
y.create.l HWIO_BLSP_BAM_BAM_P_SI_CNTXT_9_ADDR A:0x678a0838
y.create.l HWIO_BLSP_BAM_BAM_P_PSM_CNTXT_3_LSB0_ADDR A:0x67897900
y.create.l HWIO_BLSP_BAM_BAM_P_PSM_CNTXT_3_LSB1_ADDR A:0x67898900
y.create.l HWIO_BLSP_BAM_BAM_P_PSM_CNTXT_3_LSB2_ADDR A:0x67899900
y.create.l HWIO_BLSP_BAM_BAM_P_PSM_CNTXT_3_LSB3_ADDR A:0x6789a900
y.create.l HWIO_BLSP_BAM_BAM_P_PSM_CNTXT_3_LSB4_ADDR A:0x6789b900
y.create.l HWIO_BLSP_BAM_BAM_P_PSM_CNTXT_3_LSB5_ADDR A:0x6789c900
y.create.l HWIO_BLSP_BAM_BAM_P_PSM_CNTXT_3_LSB6_ADDR A:0x6789d900
y.create.l HWIO_BLSP_BAM_BAM_P_PSM_CNTXT_3_LSB7_ADDR A:0x6789e900
y.create.l HWIO_BLSP_BAM_BAM_P_PSM_CNTXT_3_LSB8_ADDR A:0x6789f900
y.create.l HWIO_BLSP_BAM_BAM_P_PSM_CNTXT_3_LSB9_ADDR A:0x678a0900
y.create.l HWIO_BLSP_BAM_BAM_P_PSM_CNTXT_3_MSB0_ADDR A:0x67897904
y.create.l HWIO_BLSP_BAM_BAM_P_PSM_CNTXT_3_MSB1_ADDR A:0x67898904
y.create.l HWIO_BLSP_BAM_BAM_P_PSM_CNTXT_3_MSB2_ADDR A:0x67899904
y.create.l HWIO_BLSP_BAM_BAM_P_PSM_CNTXT_3_MSB3_ADDR A:0x6789a904
y.create.l HWIO_BLSP_BAM_BAM_P_PSM_CNTXT_3_MSB4_ADDR A:0x6789b904
y.create.l HWIO_BLSP_BAM_BAM_P_PSM_CNTXT_3_MSB5_ADDR A:0x6789c904
y.create.l HWIO_BLSP_BAM_BAM_P_PSM_CNTXT_3_MSB6_ADDR A:0x6789d904
y.create.l HWIO_BLSP_BAM_BAM_P_PSM_CNTXT_3_MSB7_ADDR A:0x6789e904
y.create.l HWIO_BLSP_BAM_BAM_P_PSM_CNTXT_3_MSB8_ADDR A:0x6789f904
y.create.l HWIO_BLSP_BAM_BAM_P_PSM_CNTXT_3_MSB9_ADDR A:0x678a0904
y.create.l HWIO_BLSP_BAM_BAM_P_DESC_FIFO_ADDR_LSB0_ADDR A:0x67897910
y.create.l HWIO_BLSP_BAM_BAM_P_DESC_FIFO_ADDR_LSB1_ADDR A:0x67898910
y.create.l HWIO_BLSP_BAM_BAM_P_DESC_FIFO_ADDR_LSB2_ADDR A:0x67899910
y.create.l HWIO_BLSP_BAM_BAM_P_DESC_FIFO_ADDR_LSB3_ADDR A:0x6789a910
y.create.l HWIO_BLSP_BAM_BAM_P_DESC_FIFO_ADDR_LSB4_ADDR A:0x6789b910
y.create.l HWIO_BLSP_BAM_BAM_P_DESC_FIFO_ADDR_LSB5_ADDR A:0x6789c910
y.create.l HWIO_BLSP_BAM_BAM_P_DESC_FIFO_ADDR_LSB6_ADDR A:0x6789d910
y.create.l HWIO_BLSP_BAM_BAM_P_DESC_FIFO_ADDR_LSB7_ADDR A:0x6789e910
y.create.l HWIO_BLSP_BAM_BAM_P_DESC_FIFO_ADDR_LSB8_ADDR A:0x6789f910
y.create.l HWIO_BLSP_BAM_BAM_P_DESC_FIFO_ADDR_LSB9_ADDR A:0x678a0910
y.create.l HWIO_BLSP_BAM_BAM_P_DESC_FIFO_ADDR_MSB0_ADDR A:0x67897914
y.create.l HWIO_BLSP_BAM_BAM_P_DESC_FIFO_ADDR_MSB1_ADDR A:0x67898914
y.create.l HWIO_BLSP_BAM_BAM_P_DESC_FIFO_ADDR_MSB2_ADDR A:0x67899914
y.create.l HWIO_BLSP_BAM_BAM_P_DESC_FIFO_ADDR_MSB3_ADDR A:0x6789a914
y.create.l HWIO_BLSP_BAM_BAM_P_DESC_FIFO_ADDR_MSB4_ADDR A:0x6789b914
y.create.l HWIO_BLSP_BAM_BAM_P_DESC_FIFO_ADDR_MSB5_ADDR A:0x6789c914
y.create.l HWIO_BLSP_BAM_BAM_P_DESC_FIFO_ADDR_MSB6_ADDR A:0x6789d914
y.create.l HWIO_BLSP_BAM_BAM_P_DESC_FIFO_ADDR_MSB7_ADDR A:0x6789e914
y.create.l HWIO_BLSP_BAM_BAM_P_DESC_FIFO_ADDR_MSB8_ADDR A:0x6789f914
y.create.l HWIO_BLSP_BAM_BAM_P_DESC_FIFO_ADDR_MSB9_ADDR A:0x678a0914
y.create.l HWIO_BLSP_BAM_BAM_P_DATA_FIFO_ADDR_LSB0_ADDR A:0x67897920
y.create.l HWIO_BLSP_BAM_BAM_P_DATA_FIFO_ADDR_LSB1_ADDR A:0x67898920
y.create.l HWIO_BLSP_BAM_BAM_P_DATA_FIFO_ADDR_LSB2_ADDR A:0x67899920
y.create.l HWIO_BLSP_BAM_BAM_P_DATA_FIFO_ADDR_LSB3_ADDR A:0x6789a920
y.create.l HWIO_BLSP_BAM_BAM_P_DATA_FIFO_ADDR_LSB4_ADDR A:0x6789b920
y.create.l HWIO_BLSP_BAM_BAM_P_DATA_FIFO_ADDR_LSB5_ADDR A:0x6789c920
y.create.l HWIO_BLSP_BAM_BAM_P_DATA_FIFO_ADDR_LSB6_ADDR A:0x6789d920
y.create.l HWIO_BLSP_BAM_BAM_P_DATA_FIFO_ADDR_LSB7_ADDR A:0x6789e920
y.create.l HWIO_BLSP_BAM_BAM_P_DATA_FIFO_ADDR_LSB8_ADDR A:0x6789f920
y.create.l HWIO_BLSP_BAM_BAM_P_DATA_FIFO_ADDR_LSB9_ADDR A:0x678a0920
y.create.l HWIO_BLSP_BAM_BAM_P_DATA_FIFO_ADDR_MSB0_ADDR A:0x67897924
y.create.l HWIO_BLSP_BAM_BAM_P_DATA_FIFO_ADDR_MSB1_ADDR A:0x67898924
y.create.l HWIO_BLSP_BAM_BAM_P_DATA_FIFO_ADDR_MSB2_ADDR A:0x67899924
y.create.l HWIO_BLSP_BAM_BAM_P_DATA_FIFO_ADDR_MSB3_ADDR A:0x6789a924
y.create.l HWIO_BLSP_BAM_BAM_P_DATA_FIFO_ADDR_MSB4_ADDR A:0x6789b924
y.create.l HWIO_BLSP_BAM_BAM_P_DATA_FIFO_ADDR_MSB5_ADDR A:0x6789c924
y.create.l HWIO_BLSP_BAM_BAM_P_DATA_FIFO_ADDR_MSB6_ADDR A:0x6789d924
y.create.l HWIO_BLSP_BAM_BAM_P_DATA_FIFO_ADDR_MSB7_ADDR A:0x6789e924
y.create.l HWIO_BLSP_BAM_BAM_P_DATA_FIFO_ADDR_MSB8_ADDR A:0x6789f924
y.create.l HWIO_BLSP_BAM_BAM_P_DATA_FIFO_ADDR_MSB9_ADDR A:0x678a0924
y.create.l HWIO_BLSP_BAM_BAM_P_EVNT_DEST_ADDR_LSB0_ADDR A:0x67897930
y.create.l HWIO_BLSP_BAM_BAM_P_EVNT_DEST_ADDR_LSB1_ADDR A:0x67898930
y.create.l HWIO_BLSP_BAM_BAM_P_EVNT_DEST_ADDR_LSB2_ADDR A:0x67899930
y.create.l HWIO_BLSP_BAM_BAM_P_EVNT_DEST_ADDR_LSB3_ADDR A:0x6789a930
y.create.l HWIO_BLSP_BAM_BAM_P_EVNT_DEST_ADDR_LSB4_ADDR A:0x6789b930
y.create.l HWIO_BLSP_BAM_BAM_P_EVNT_DEST_ADDR_LSB5_ADDR A:0x6789c930
y.create.l HWIO_BLSP_BAM_BAM_P_EVNT_DEST_ADDR_LSB6_ADDR A:0x6789d930
y.create.l HWIO_BLSP_BAM_BAM_P_EVNT_DEST_ADDR_LSB7_ADDR A:0x6789e930
y.create.l HWIO_BLSP_BAM_BAM_P_EVNT_DEST_ADDR_LSB8_ADDR A:0x6789f930
y.create.l HWIO_BLSP_BAM_BAM_P_EVNT_DEST_ADDR_LSB9_ADDR A:0x678a0930
y.create.l HWIO_BLSP_BAM_BAM_P_EVNT_DEST_ADDR_MSB0_ADDR A:0x67897934
y.create.l HWIO_BLSP_BAM_BAM_P_EVNT_DEST_ADDR_MSB1_ADDR A:0x67898934
y.create.l HWIO_BLSP_BAM_BAM_P_EVNT_DEST_ADDR_MSB2_ADDR A:0x67899934
y.create.l HWIO_BLSP_BAM_BAM_P_EVNT_DEST_ADDR_MSB3_ADDR A:0x6789a934
y.create.l HWIO_BLSP_BAM_BAM_P_EVNT_DEST_ADDR_MSB4_ADDR A:0x6789b934
y.create.l HWIO_BLSP_BAM_BAM_P_EVNT_DEST_ADDR_MSB5_ADDR A:0x6789c934
y.create.l HWIO_BLSP_BAM_BAM_P_EVNT_DEST_ADDR_MSB6_ADDR A:0x6789d934
y.create.l HWIO_BLSP_BAM_BAM_P_EVNT_DEST_ADDR_MSB7_ADDR A:0x6789e934
y.create.l HWIO_BLSP_BAM_BAM_P_EVNT_DEST_ADDR_MSB8_ADDR A:0x6789f934
y.create.l HWIO_BLSP_BAM_BAM_P_EVNT_DEST_ADDR_MSB9_ADDR A:0x678a0934
y.create.l HWIO_BLSP_BAM_XPU_SCR_ADDR A:0x67882000
y.create.l HWIO_BLSP_BAM_XPU_SWDR_ADDR A:0x67882004
y.create.l HWIO_BLSP_BAM_XPU_SEAR0_ADDR A:0x67882040
y.create.l HWIO_BLSP_BAM_XPU_SESR_ADDR A:0x67882048
y.create.l HWIO_BLSP_BAM_XPU_SESRRESTORE_ADDR A:0x6788204c
y.create.l HWIO_BLSP_BAM_XPU_SESYNR0_ADDR A:0x67882050
y.create.l HWIO_BLSP_BAM_XPU_SESYNR1_ADDR A:0x67882054
y.create.l HWIO_BLSP_BAM_XPU_SESYNR2_ADDR A:0x67882058
y.create.l HWIO_BLSP_BAM_XPU_MCR_ADDR A:0x67882100
y.create.l HWIO_BLSP_BAM_XPU_MEAR0_ADDR A:0x67882140
y.create.l HWIO_BLSP_BAM_XPU_MESR_ADDR A:0x67882148
y.create.l HWIO_BLSP_BAM_XPU_MESRRESTORE_ADDR A:0x6788214c
y.create.l HWIO_BLSP_BAM_XPU_MESYNR0_ADDR A:0x67882150
y.create.l HWIO_BLSP_BAM_XPU_MESYNR1_ADDR A:0x67882154
y.create.l HWIO_BLSP_BAM_XPU_MESYNR2_ADDR A:0x67882158
y.create.l HWIO_BLSP_BAM_XPU_CR_ADDR A:0x67882080
y.create.l HWIO_BLSP_BAM_XPU_RPU_ACR0_ADDR A:0x678820a0
y.create.l HWIO_BLSP_BAM_XPU_EAR0_ADDR A:0x678820c0
y.create.l HWIO_BLSP_BAM_XPU_ESR_ADDR A:0x678820c8
y.create.l HWIO_BLSP_BAM_XPU_ESRRESTORE_ADDR A:0x678820cc
y.create.l HWIO_BLSP_BAM_XPU_ESYNR0_ADDR A:0x678820d0
y.create.l HWIO_BLSP_BAM_XPU_ESYNR1_ADDR A:0x678820d4
y.create.l HWIO_BLSP_BAM_XPU_ESYNR2_ADDR A:0x678820d8
y.create.l HWIO_BLSP_BAM_XPU_IDR0_ADDR A:0x67882074
y.create.l HWIO_BLSP_BAM_XPU_IDR1_ADDR A:0x67882078
y.create.l HWIO_BLSP_BAM_XPU_REV_ADDR A:0x6788207c
y.create.l HWIO_BLSP_BAM_XPU_RG0_RACR0_ADDR A:0x67882200
y.create.l HWIO_BLSP_BAM_XPU_RG1_RACR0_ADDR A:0x67882280
y.create.l HWIO_BLSP_BAM_XPU_RG2_RACR0_ADDR A:0x67882300
y.create.l HWIO_BLSP_BAM_XPU_RG3_RACR0_ADDR A:0x67882380
y.create.l HWIO_BLSP_BAM_XPU_RG4_RACR0_ADDR A:0x67882400
y.create.l HWIO_BLSP_BAM_XPU_RG5_RACR0_ADDR A:0x67882480
y.create.l HWIO_BLSP_BAM_XPU_RG6_RACR0_ADDR A:0x67882500
y.create.l HWIO_BLSP_BAM_XPU_RG7_RACR0_ADDR A:0x67882580
y.create.l HWIO_BLSP_BAM_XPU_RG8_RACR0_ADDR A:0x67882600
y.create.l HWIO_BLSP_BAM_XPU_RG9_RACR0_ADDR A:0x67882680
y.create.l HWIO_BLSP_BAM_XPU_RG0_SCR_ADDR A:0x67882250
y.create.l HWIO_BLSP_BAM_XPU_RG1_SCR_ADDR A:0x678822d0
y.create.l HWIO_BLSP_BAM_XPU_RG2_SCR_ADDR A:0x67882350
y.create.l HWIO_BLSP_BAM_XPU_RG3_SCR_ADDR A:0x678823d0
y.create.l HWIO_BLSP_BAM_XPU_RG4_SCR_ADDR A:0x67882450
y.create.l HWIO_BLSP_BAM_XPU_RG5_SCR_ADDR A:0x678824d0
y.create.l HWIO_BLSP_BAM_XPU_RG6_SCR_ADDR A:0x67882550
y.create.l HWIO_BLSP_BAM_XPU_RG7_SCR_ADDR A:0x678825d0
y.create.l HWIO_BLSP_BAM_XPU_RG8_SCR_ADDR A:0x67882650
y.create.l HWIO_BLSP_BAM_XPU_RG9_SCR_ADDR A:0x678826d0
y.create.l HWIO_BLSP_BAM_XPU_RG0_MCR_ADDR A:0x67882254
y.create.l HWIO_BLSP_BAM_XPU_RG1_MCR_ADDR A:0x678822d4
y.create.l HWIO_BLSP_BAM_XPU_RG2_MCR_ADDR A:0x67882354
y.create.l HWIO_BLSP_BAM_XPU_RG3_MCR_ADDR A:0x678823d4
y.create.l HWIO_BLSP_BAM_XPU_RG4_MCR_ADDR A:0x67882454
y.create.l HWIO_BLSP_BAM_XPU_RG5_MCR_ADDR A:0x678824d4
y.create.l HWIO_BLSP_BAM_XPU_RG6_MCR_ADDR A:0x67882554
y.create.l HWIO_BLSP_BAM_XPU_RG7_MCR_ADDR A:0x678825d4
y.create.l HWIO_BLSP_BAM_XPU_RG8_MCR_ADDR A:0x67882654
y.create.l HWIO_BLSP_BAM_XPU_RG9_MCR_ADDR A:0x678826d4
y.create.l HWIO_BLSP_BAM_VMIDMT_SCR0_ADDR A:0x67880000
y.create.l HWIO_BLSP_BAM_VMIDMT_SCR1_ADDR A:0x67880004
y.create.l HWIO_BLSP_BAM_VMIDMT_SCR2_ADDR A:0x67880008
y.create.l HWIO_BLSP_BAM_VMIDMT_SACR_ADDR A:0x67880010
y.create.l HWIO_BLSP_BAM_VMIDMT_SIDR0_ADDR A:0x67880020
y.create.l HWIO_BLSP_BAM_VMIDMT_SIDR1_ADDR A:0x67880024
y.create.l HWIO_BLSP_BAM_VMIDMT_SIDR2_ADDR A:0x67880028
y.create.l HWIO_BLSP_BAM_VMIDMT_SIDR4_ADDR A:0x67880030
y.create.l HWIO_BLSP_BAM_VMIDMT_SIDR5_ADDR A:0x67880034
y.create.l HWIO_BLSP_BAM_VMIDMT_SIDR7_ADDR A:0x6788003c
y.create.l HWIO_BLSP_BAM_VMIDMT_SGFAR0_ADDR A:0x67880040
y.create.l HWIO_BLSP_BAM_VMIDMT_SGFSR_ADDR A:0x67880048
y.create.l HWIO_BLSP_BAM_VMIDMT_SGFSRRESTORE_ADDR A:0x6788004c
y.create.l HWIO_BLSP_BAM_VMIDMT_SGFSYNDR0_ADDR A:0x67880050
y.create.l HWIO_BLSP_BAM_VMIDMT_SGFSYNDR1_ADDR A:0x67880054
y.create.l HWIO_BLSP_BAM_VMIDMT_SGFSYNDR2_ADDR A:0x67880058
y.create.l HWIO_BLSP_BAM_VMIDMT_VMIDMTSCR0_ADDR A:0x67880090
y.create.l HWIO_BLSP_BAM_VMIDMT_CR0_ADDR A:0x67880000
y.create.l HWIO_BLSP_BAM_VMIDMT_CR2_ADDR A:0x67880008
y.create.l HWIO_BLSP_BAM_VMIDMT_ACR_ADDR A:0x67880010
y.create.l HWIO_BLSP_BAM_VMIDMT_IDR0_ADDR A:0x67880020
y.create.l HWIO_BLSP_BAM_VMIDMT_IDR1_ADDR A:0x67880024
y.create.l HWIO_BLSP_BAM_VMIDMT_IDR2_ADDR A:0x67880028
y.create.l HWIO_BLSP_BAM_VMIDMT_IDR4_ADDR A:0x67880030
y.create.l HWIO_BLSP_BAM_VMIDMT_IDR5_ADDR A:0x67880034
y.create.l HWIO_BLSP_BAM_VMIDMT_IDR7_ADDR A:0x6788003c
y.create.l HWIO_BLSP_BAM_VMIDMT_GFAR0_ADDR A:0x67880040
y.create.l HWIO_BLSP_BAM_VMIDMT_GFSR_ADDR A:0x67880048
y.create.l HWIO_BLSP_BAM_VMIDMT_GFSRRESTORE_ADDR A:0x6788004c
y.create.l HWIO_BLSP_BAM_VMIDMT_GFSYNDR0_ADDR A:0x67880050
y.create.l HWIO_BLSP_BAM_VMIDMT_GFSYNDR1_ADDR A:0x67880054
y.create.l HWIO_BLSP_BAM_VMIDMT_GFSYNDR2_ADDR A:0x67880058
y.create.l HWIO_BLSP_BAM_VMIDMT_VMIDMTCR0_ADDR A:0x67880090
y.create.l HWIO_BLSP_BAM_VMIDMT_VMIDMTACR_ADDR A:0x6788009c
y.create.l HWIO_BLSP_BAM_VMIDMT_NSCR0_ADDR A:0x67880400
y.create.l HWIO_BLSP_BAM_VMIDMT_NSCR2_ADDR A:0x67880408
y.create.l HWIO_BLSP_BAM_VMIDMT_NSACR_ADDR A:0x67880410
y.create.l HWIO_BLSP_BAM_VMIDMT_NSGFAR0_ADDR A:0x67880440
y.create.l HWIO_BLSP_BAM_VMIDMT_NSGFSR_ADDR A:0x67880448
y.create.l HWIO_BLSP_BAM_VMIDMT_NSGFSRRESTORE_ADDR A:0x6788044c
y.create.l HWIO_BLSP_BAM_VMIDMT_NSGFSYNDR0_ADDR A:0x67880450
y.create.l HWIO_BLSP_BAM_VMIDMT_NSGFSYNDR1_ADDR A:0x67880454
y.create.l HWIO_BLSP_BAM_VMIDMT_NSGFSYNDR2_ADDR A:0x67880458
y.create.l HWIO_BLSP_BAM_VMIDMT_NSVMIDMTCR0_ADDR A:0x67880490
y.create.l HWIO_BLSP_BAM_VMIDMT_SSDR0_ADDR A:0x67880080
y.create.l HWIO_BLSP_BAM_VMIDMT_MSDR0_ADDR A:0x67880480
y.create.l HWIO_BLSP_BAM_VMIDMT_MCR_ADDR A:0x67880494
y.create.l HWIO_BLSP_BAM_VMIDMT_S2VR0_ADDR A:0x67880c00
y.create.l HWIO_BLSP_BAM_VMIDMT_S2VR1_ADDR A:0x67880c04
y.create.l HWIO_BLSP_BAM_VMIDMT_S2VR2_ADDR A:0x67880c08
y.create.l HWIO_BLSP_BAM_VMIDMT_S2VR3_ADDR A:0x67880c0c
y.create.l HWIO_BLSP_BAM_VMIDMT_S2VR4_ADDR A:0x67880c10
y.create.l HWIO_BLSP_BAM_VMIDMT_S2VR5_ADDR A:0x67880c14
y.create.l HWIO_BLSP_BAM_VMIDMT_S2VR6_ADDR A:0x67880c18
y.create.l HWIO_BLSP_BAM_VMIDMT_S2VR7_ADDR A:0x67880c1c
y.create.l HWIO_BLSP_BAM_VMIDMT_S2VR8_ADDR A:0x67880c20
y.create.l HWIO_BLSP_BAM_VMIDMT_S2VR9_ADDR A:0x67880c24
y.create.l HWIO_BLSP_BAM_VMIDMT_AS2VR0_ADDR A:0x67880e00
y.create.l HWIO_BLSP_BAM_VMIDMT_AS2VR1_ADDR A:0x67880e04
y.create.l HWIO_BLSP_BAM_VMIDMT_AS2VR2_ADDR A:0x67880e08
y.create.l HWIO_BLSP_BAM_VMIDMT_AS2VR3_ADDR A:0x67880e0c
y.create.l HWIO_BLSP_BAM_VMIDMT_AS2VR4_ADDR A:0x67880e10
y.create.l HWIO_BLSP_BAM_VMIDMT_AS2VR5_ADDR A:0x67880e14
y.create.l HWIO_BLSP_BAM_VMIDMT_AS2VR6_ADDR A:0x67880e18
y.create.l HWIO_BLSP_BAM_VMIDMT_AS2VR7_ADDR A:0x67880e1c
y.create.l HWIO_BLSP_BAM_VMIDMT_AS2VR8_ADDR A:0x67880e20
y.create.l HWIO_BLSP_BAM_VMIDMT_AS2VR9_ADDR A:0x67880e24
y.create.l HWIO_BLSP_BAM_VMIDMT_SMR0_ADDR A:0x67880800
y.create.l HWIO_BLSP_BAM_VMIDMT_SMR1_ADDR A:0x67880804
y.create.l HWIO_BLSP_BAM_VMIDMT_SMR2_ADDR A:0x67880808
y.create.l HWIO_BLSP_BAM_VMIDMT_SMR3_ADDR A:0x6788080c
y.create.l HWIO_BLSP_BAM_VMIDMT_SMR4_ADDR A:0x67880810
y.create.l HWIO_BLSP_BAM_VMIDMT_SMR5_ADDR A:0x67880814
y.create.l HWIO_BLSP_BAM_VMIDMT_SMR6_ADDR A:0x67880818
y.create.l HWIO_BLSP_BAM_VMIDMT_SMR7_ADDR A:0x6788081c
y.create.l HWIO_BLSP_BAM_VMIDMT_SMR8_ADDR A:0x67880820
y.create.l HWIO_BLSP_BAM_VMIDMT_SMR9_ADDR A:0x67880824
y.create.l HWIO_BLSP_UART0_UART_DM_MR1_ADDR A:0x678af000
y.create.l HWIO_BLSP_UART0_UART_DM_MR2_ADDR A:0x678af004
y.create.l HWIO_BLSP_UART0_UART_DM_CSR_SR_DEPRECATED_ADDR A:0x678af008
y.create.l HWIO_BLSP_UART0_UART_DM_CR_MISR_DEPRECATED_ADDR A:0x678af010
y.create.l HWIO_BLSP_UART0_UART_DM_IMR_ISR_DEPRECATED_ADDR A:0x678af014
y.create.l HWIO_BLSP_UART0_UART_DM_IPR_ADDR A:0x678af018
y.create.l HWIO_BLSP_UART0_UART_DM_TFWR_ADDR A:0x678af01c
y.create.l HWIO_BLSP_UART0_UART_DM_RFWR_ADDR A:0x678af020
y.create.l HWIO_BLSP_UART0_UART_DM_HCR_ADDR A:0x678af024
y.create.l HWIO_BLSP_UART0_UART_DM_DMRX_ADDR A:0x678af034
y.create.l HWIO_BLSP_UART0_UART_DM_IRDA_RX_TOTAL_SNAP_DEPRECATED_ADDR A:0x678af038
y.create.l HWIO_BLSP_UART0_UART_DM_DMEN_ADDR A:0x678af03c
y.create.l HWIO_BLSP_UART0_UART_DM_NO_CHARS_FOR_TX_ADDR A:0x678af040
y.create.l HWIO_BLSP_UART0_UART_DM_BADR_ADDR A:0x678af044
y.create.l HWIO_BLSP_UART0_UART_DM_TESTSL_ADDR A:0x678af048
y.create.l HWIO_BLSP_UART0_UART_DM_TXFS_ADDR A:0x678af04c
y.create.l HWIO_BLSP_UART0_UART_DM_RXFS_ADDR A:0x678af050
y.create.l HWIO_BLSP_UART0_UART_DM_MISR_MODE_ADDR A:0x678af060
y.create.l HWIO_BLSP_UART0_UART_DM_MISR_RESET_ADDR A:0x678af064
y.create.l HWIO_BLSP_UART0_UART_DM_MISR_EXPORT_ADDR A:0x678af068
y.create.l HWIO_BLSP_UART0_UART_DM_MISR_VAL_ADDR A:0x678af06c
y.create.l HWIO_BLSP_UART0_UART_DM_TF_RF_DEPRECATED_ADDR A:0x678af070
y.create.l HWIO_BLSP_UART0_UART_DM_TF_RF_2_DEPRECATED_ADDR A:0x678af074
y.create.l HWIO_BLSP_UART0_UART_DM_TF_RF_3_DEPRECATED_ADDR A:0x678af078
y.create.l HWIO_BLSP_UART0_UART_DM_TF_RF_4_DEPRECATED_ADDR A:0x678af07c
y.create.l HWIO_BLSP_UART0_UART_DM_SIM_CFG_ADDR A:0x678af080
y.create.l HWIO_BLSP_UART0_UART_DM_TEST_WR_ADDR_ADDR A:0x678af084
y.create.l HWIO_BLSP_UART0_UART_DM_TEST_WR_DATA_ADDR A:0x678af088
y.create.l HWIO_BLSP_UART0_UART_DM_TEST_RD_ADDR_ADDR A:0x678af08c
y.create.l HWIO_BLSP_UART0_UART_DM_TEST_RD_DATA_ADDR A:0x678af090
y.create.l HWIO_BLSP_UART0_UART_DM_CSR_ADDR A:0x678af0a0
y.create.l HWIO_BLSP_UART0_UART_DM_SR_ADDR A:0x678af0a4
y.create.l HWIO_BLSP_UART0_UART_DM_CR_ADDR A:0x678af0a8
y.create.l HWIO_BLSP_UART0_UART_DM_MISR_ADDR A:0x678af0ac
y.create.l HWIO_BLSP_UART0_UART_DM_IMR_ADDR A:0x678af0b0
y.create.l HWIO_BLSP_UART0_UART_DM_ISR_ADDR A:0x678af0b4
y.create.l HWIO_BLSP_UART0_UART_DM_IRDA_ADDR A:0x678af0b8
y.create.l HWIO_BLSP_UART0_UART_DM_RX_TOTAL_SNAP_ADDR A:0x678af0bc
y.create.l HWIO_BLSP_UART0_UART_DM_WWT_TIMEOUT_ADDR A:0x678af0c0
y.create.l HWIO_BLSP_UART0_UART_DM_CLK_CTRL_ADDR A:0x678af0c4
y.create.l HWIO_BLSP_UART0_UART_DM_BCR_ADDR A:0x678af0c8
y.create.l HWIO_BLSP_UART0_UART_DM_RX_TRANS_CTRL_ADDR A:0x678af0cc
y.create.l HWIO_BLSP_UART0_UART_DM_DMRX_DBG_ADDR A:0x678af0d0
y.create.l HWIO_BLSP_UART0_UART_DM_FSM_STATUS_ADDR A:0x678af0d4
y.create.l HWIO_BLSP_UART0_UART_DM_HW_VERSION_ADDR A:0x678af0d8
y.create.l HWIO_BLSP_UART0_UART_DM_GENERICS_ADDR A:0x678af0dc
y.create.l HWIO_BLSP_UART0_UART_DM_TF_ADDR A:0x678af100
y.create.l HWIO_BLSP_UART0_UART_DM_TF_2_ADDR A:0x678af104
y.create.l HWIO_BLSP_UART0_UART_DM_TF_3_ADDR A:0x678af108
y.create.l HWIO_BLSP_UART0_UART_DM_TF_4_ADDR A:0x678af10c
y.create.l HWIO_BLSP_UART0_UART_DM_TF_5_ADDR A:0x678af110
y.create.l HWIO_BLSP_UART0_UART_DM_TF_6_ADDR A:0x678af114
y.create.l HWIO_BLSP_UART0_UART_DM_TF_7_ADDR A:0x678af118
y.create.l HWIO_BLSP_UART0_UART_DM_TF_8_ADDR A:0x678af11c
y.create.l HWIO_BLSP_UART0_UART_DM_TF_9_ADDR A:0x678af120
y.create.l HWIO_BLSP_UART0_UART_DM_TF_10_ADDR A:0x678af124
y.create.l HWIO_BLSP_UART0_UART_DM_TF_11_ADDR A:0x678af128
y.create.l HWIO_BLSP_UART0_UART_DM_TF_12_ADDR A:0x678af12c
y.create.l HWIO_BLSP_UART0_UART_DM_TF_13_ADDR A:0x678af130
y.create.l HWIO_BLSP_UART0_UART_DM_TF_14_ADDR A:0x678af134
y.create.l HWIO_BLSP_UART0_UART_DM_TF_15_ADDR A:0x678af138
y.create.l HWIO_BLSP_UART0_UART_DM_TF_16_ADDR A:0x678af13c
y.create.l HWIO_BLSP_UART0_UART_DM_RF_ADDR A:0x678af140
y.create.l HWIO_BLSP_UART0_UART_DM_RF_2_ADDR A:0x678af144
y.create.l HWIO_BLSP_UART0_UART_DM_RF_3_ADDR A:0x678af148
y.create.l HWIO_BLSP_UART0_UART_DM_RF_4_ADDR A:0x678af14c
y.create.l HWIO_BLSP_UART0_UART_DM_RF_5_ADDR A:0x678af150
y.create.l HWIO_BLSP_UART0_UART_DM_RF_6_ADDR A:0x678af154
y.create.l HWIO_BLSP_UART0_UART_DM_RF_7_ADDR A:0x678af158
y.create.l HWIO_BLSP_UART0_UART_DM_RF_8_ADDR A:0x678af15c
y.create.l HWIO_BLSP_UART0_UART_DM_RF_9_ADDR A:0x678af160
y.create.l HWIO_BLSP_UART0_UART_DM_RF_10_ADDR A:0x678af164
y.create.l HWIO_BLSP_UART0_UART_DM_RF_11_ADDR A:0x678af168
y.create.l HWIO_BLSP_UART0_UART_DM_RF_12_ADDR A:0x678af16c
y.create.l HWIO_BLSP_UART0_UART_DM_RF_13_ADDR A:0x678af170
y.create.l HWIO_BLSP_UART0_UART_DM_RF_14_ADDR A:0x678af174
y.create.l HWIO_BLSP_UART0_UART_DM_RF_15_ADDR A:0x678af178
y.create.l HWIO_BLSP_UART0_UART_DM_RF_16_ADDR A:0x678af17c
y.create.l HWIO_BLSP_UART0_UART_DM_UIM_CFG_ADDR A:0x678af180
y.create.l HWIO_BLSP_UART0_UART_DM_UIM_CMD_ADDR A:0x678af184
y.create.l HWIO_BLSP_UART0_UART_DM_UIM_IO_STATUS_ADDR A:0x678af188
y.create.l HWIO_BLSP_UART0_UART_DM_UIM_IRQ_ISR_ADDR A:0x678af18c
y.create.l HWIO_BLSP_UART0_UART_DM_UIM_IRQ_MISR_ADDR A:0x678af190
y.create.l HWIO_BLSP_UART0_UART_DM_UIM_IRQ_CLR_ADDR A:0x678af194
y.create.l HWIO_BLSP_UART0_UART_DM_UIM_IRQ_IMR_ADDR A:0x678af198
y.create.l HWIO_BLSP_UART0_UART_DM_UIM_IRQ_IMR_SET_ADDR A:0x678af19c
y.create.l HWIO_BLSP_UART0_UART_DM_UIM_IRQ_IMR_CLR_ADDR A:0x678af1a0
y.create.l HWIO_BLSP_UART1_UART_DM_MR1_ADDR A:0x678b0000
y.create.l HWIO_BLSP_UART1_UART_DM_MR2_ADDR A:0x678b0004
y.create.l HWIO_BLSP_UART1_UART_DM_CSR_SR_DEPRECATED_ADDR A:0x678b0008
y.create.l HWIO_BLSP_UART1_UART_DM_CR_MISR_DEPRECATED_ADDR A:0x678b0010
y.create.l HWIO_BLSP_UART1_UART_DM_IMR_ISR_DEPRECATED_ADDR A:0x678b0014
y.create.l HWIO_BLSP_UART1_UART_DM_IPR_ADDR A:0x678b0018
y.create.l HWIO_BLSP_UART1_UART_DM_TFWR_ADDR A:0x678b001c
y.create.l HWIO_BLSP_UART1_UART_DM_RFWR_ADDR A:0x678b0020
y.create.l HWIO_BLSP_UART1_UART_DM_HCR_ADDR A:0x678b0024
y.create.l HWIO_BLSP_UART1_UART_DM_DMRX_ADDR A:0x678b0034
y.create.l HWIO_BLSP_UART1_UART_DM_IRDA_RX_TOTAL_SNAP_DEPRECATED_ADDR A:0x678b0038
y.create.l HWIO_BLSP_UART1_UART_DM_DMEN_ADDR A:0x678b003c
y.create.l HWIO_BLSP_UART1_UART_DM_NO_CHARS_FOR_TX_ADDR A:0x678b0040
y.create.l HWIO_BLSP_UART1_UART_DM_BADR_ADDR A:0x678b0044
y.create.l HWIO_BLSP_UART1_UART_DM_TESTSL_ADDR A:0x678b0048
y.create.l HWIO_BLSP_UART1_UART_DM_TXFS_ADDR A:0x678b004c
y.create.l HWIO_BLSP_UART1_UART_DM_RXFS_ADDR A:0x678b0050
y.create.l HWIO_BLSP_UART1_UART_DM_MISR_MODE_ADDR A:0x678b0060
y.create.l HWIO_BLSP_UART1_UART_DM_MISR_RESET_ADDR A:0x678b0064
y.create.l HWIO_BLSP_UART1_UART_DM_MISR_EXPORT_ADDR A:0x678b0068
y.create.l HWIO_BLSP_UART1_UART_DM_MISR_VAL_ADDR A:0x678b006c
y.create.l HWIO_BLSP_UART1_UART_DM_TF_RF_DEPRECATED_ADDR A:0x678b0070
y.create.l HWIO_BLSP_UART1_UART_DM_TF_RF_2_DEPRECATED_ADDR A:0x678b0074
y.create.l HWIO_BLSP_UART1_UART_DM_TF_RF_3_DEPRECATED_ADDR A:0x678b0078
y.create.l HWIO_BLSP_UART1_UART_DM_TF_RF_4_DEPRECATED_ADDR A:0x678b007c
y.create.l HWIO_BLSP_UART1_UART_DM_SIM_CFG_ADDR A:0x678b0080
y.create.l HWIO_BLSP_UART1_UART_DM_TEST_WR_ADDR_ADDR A:0x678b0084
y.create.l HWIO_BLSP_UART1_UART_DM_TEST_WR_DATA_ADDR A:0x678b0088
y.create.l HWIO_BLSP_UART1_UART_DM_TEST_RD_ADDR_ADDR A:0x678b008c
y.create.l HWIO_BLSP_UART1_UART_DM_TEST_RD_DATA_ADDR A:0x678b0090
y.create.l HWIO_BLSP_UART1_UART_DM_CSR_ADDR A:0x678b00a0
y.create.l HWIO_BLSP_UART1_UART_DM_SR_ADDR A:0x678b00a4
y.create.l HWIO_BLSP_UART1_UART_DM_CR_ADDR A:0x678b00a8
y.create.l HWIO_BLSP_UART1_UART_DM_MISR_ADDR A:0x678b00ac
y.create.l HWIO_BLSP_UART1_UART_DM_IMR_ADDR A:0x678b00b0
y.create.l HWIO_BLSP_UART1_UART_DM_ISR_ADDR A:0x678b00b4
y.create.l HWIO_BLSP_UART1_UART_DM_IRDA_ADDR A:0x678b00b8
y.create.l HWIO_BLSP_UART1_UART_DM_RX_TOTAL_SNAP_ADDR A:0x678b00bc
y.create.l HWIO_BLSP_UART1_UART_DM_WWT_TIMEOUT_ADDR A:0x678b00c0
y.create.l HWIO_BLSP_UART1_UART_DM_CLK_CTRL_ADDR A:0x678b00c4
y.create.l HWIO_BLSP_UART1_UART_DM_BCR_ADDR A:0x678b00c8
y.create.l HWIO_BLSP_UART1_UART_DM_RX_TRANS_CTRL_ADDR A:0x678b00cc
y.create.l HWIO_BLSP_UART1_UART_DM_DMRX_DBG_ADDR A:0x678b00d0
y.create.l HWIO_BLSP_UART1_UART_DM_FSM_STATUS_ADDR A:0x678b00d4
y.create.l HWIO_BLSP_UART1_UART_DM_HW_VERSION_ADDR A:0x678b00d8
y.create.l HWIO_BLSP_UART1_UART_DM_GENERICS_ADDR A:0x678b00dc
y.create.l HWIO_BLSP_UART1_UART_DM_TF_ADDR A:0x678b0100
y.create.l HWIO_BLSP_UART1_UART_DM_TF_2_ADDR A:0x678b0104
y.create.l HWIO_BLSP_UART1_UART_DM_TF_3_ADDR A:0x678b0108
y.create.l HWIO_BLSP_UART1_UART_DM_TF_4_ADDR A:0x678b010c
y.create.l HWIO_BLSP_UART1_UART_DM_TF_5_ADDR A:0x678b0110
y.create.l HWIO_BLSP_UART1_UART_DM_TF_6_ADDR A:0x678b0114
y.create.l HWIO_BLSP_UART1_UART_DM_TF_7_ADDR A:0x678b0118
y.create.l HWIO_BLSP_UART1_UART_DM_TF_8_ADDR A:0x678b011c
y.create.l HWIO_BLSP_UART1_UART_DM_TF_9_ADDR A:0x678b0120
y.create.l HWIO_BLSP_UART1_UART_DM_TF_10_ADDR A:0x678b0124
y.create.l HWIO_BLSP_UART1_UART_DM_TF_11_ADDR A:0x678b0128
y.create.l HWIO_BLSP_UART1_UART_DM_TF_12_ADDR A:0x678b012c
y.create.l HWIO_BLSP_UART1_UART_DM_TF_13_ADDR A:0x678b0130
y.create.l HWIO_BLSP_UART1_UART_DM_TF_14_ADDR A:0x678b0134
y.create.l HWIO_BLSP_UART1_UART_DM_TF_15_ADDR A:0x678b0138
y.create.l HWIO_BLSP_UART1_UART_DM_TF_16_ADDR A:0x678b013c
y.create.l HWIO_BLSP_UART1_UART_DM_RF_ADDR A:0x678b0140
y.create.l HWIO_BLSP_UART1_UART_DM_RF_2_ADDR A:0x678b0144
y.create.l HWIO_BLSP_UART1_UART_DM_RF_3_ADDR A:0x678b0148
y.create.l HWIO_BLSP_UART1_UART_DM_RF_4_ADDR A:0x678b014c
y.create.l HWIO_BLSP_UART1_UART_DM_RF_5_ADDR A:0x678b0150
y.create.l HWIO_BLSP_UART1_UART_DM_RF_6_ADDR A:0x678b0154
y.create.l HWIO_BLSP_UART1_UART_DM_RF_7_ADDR A:0x678b0158
y.create.l HWIO_BLSP_UART1_UART_DM_RF_8_ADDR A:0x678b015c
y.create.l HWIO_BLSP_UART1_UART_DM_RF_9_ADDR A:0x678b0160
y.create.l HWIO_BLSP_UART1_UART_DM_RF_10_ADDR A:0x678b0164
y.create.l HWIO_BLSP_UART1_UART_DM_RF_11_ADDR A:0x678b0168
y.create.l HWIO_BLSP_UART1_UART_DM_RF_12_ADDR A:0x678b016c
y.create.l HWIO_BLSP_UART1_UART_DM_RF_13_ADDR A:0x678b0170
y.create.l HWIO_BLSP_UART1_UART_DM_RF_14_ADDR A:0x678b0174
y.create.l HWIO_BLSP_UART1_UART_DM_RF_15_ADDR A:0x678b0178
y.create.l HWIO_BLSP_UART1_UART_DM_RF_16_ADDR A:0x678b017c
y.create.l HWIO_BLSP_UART1_UART_DM_UIM_CFG_ADDR A:0x678b0180
y.create.l HWIO_BLSP_UART1_UART_DM_UIM_CMD_ADDR A:0x678b0184
y.create.l HWIO_BLSP_UART1_UART_DM_UIM_IO_STATUS_ADDR A:0x678b0188
y.create.l HWIO_BLSP_UART1_UART_DM_UIM_IRQ_ISR_ADDR A:0x678b018c
y.create.l HWIO_BLSP_UART1_UART_DM_UIM_IRQ_MISR_ADDR A:0x678b0190
y.create.l HWIO_BLSP_UART1_UART_DM_UIM_IRQ_CLR_ADDR A:0x678b0194
y.create.l HWIO_BLSP_UART1_UART_DM_UIM_IRQ_IMR_ADDR A:0x678b0198
y.create.l HWIO_BLSP_UART1_UART_DM_UIM_IRQ_IMR_SET_ADDR A:0x678b019c
y.create.l HWIO_BLSP_UART1_UART_DM_UIM_IRQ_IMR_CLR_ADDR A:0x678b01a0
y.create.l HWIO_BLSP_UART2_UART_DM_MR1_ADDR A:0x678b1000
y.create.l HWIO_BLSP_UART2_UART_DM_MR2_ADDR A:0x678b1004
y.create.l HWIO_BLSP_UART2_UART_DM_CSR_SR_DEPRECATED_ADDR A:0x678b1008
y.create.l HWIO_BLSP_UART2_UART_DM_CR_MISR_DEPRECATED_ADDR A:0x678b1010
y.create.l HWIO_BLSP_UART2_UART_DM_IMR_ISR_DEPRECATED_ADDR A:0x678b1014
y.create.l HWIO_BLSP_UART2_UART_DM_IPR_ADDR A:0x678b1018
y.create.l HWIO_BLSP_UART2_UART_DM_TFWR_ADDR A:0x678b101c
y.create.l HWIO_BLSP_UART2_UART_DM_RFWR_ADDR A:0x678b1020
y.create.l HWIO_BLSP_UART2_UART_DM_HCR_ADDR A:0x678b1024
y.create.l HWIO_BLSP_UART2_UART_DM_DMRX_ADDR A:0x678b1034
y.create.l HWIO_BLSP_UART2_UART_DM_IRDA_RX_TOTAL_SNAP_DEPRECATED_ADDR A:0x678b1038
y.create.l HWIO_BLSP_UART2_UART_DM_DMEN_ADDR A:0x678b103c
y.create.l HWIO_BLSP_UART2_UART_DM_NO_CHARS_FOR_TX_ADDR A:0x678b1040
y.create.l HWIO_BLSP_UART2_UART_DM_BADR_ADDR A:0x678b1044
y.create.l HWIO_BLSP_UART2_UART_DM_TESTSL_ADDR A:0x678b1048
y.create.l HWIO_BLSP_UART2_UART_DM_TXFS_ADDR A:0x678b104c
y.create.l HWIO_BLSP_UART2_UART_DM_RXFS_ADDR A:0x678b1050
y.create.l HWIO_BLSP_UART2_UART_DM_MISR_MODE_ADDR A:0x678b1060
y.create.l HWIO_BLSP_UART2_UART_DM_MISR_RESET_ADDR A:0x678b1064
y.create.l HWIO_BLSP_UART2_UART_DM_MISR_EXPORT_ADDR A:0x678b1068
y.create.l HWIO_BLSP_UART2_UART_DM_MISR_VAL_ADDR A:0x678b106c
y.create.l HWIO_BLSP_UART2_UART_DM_TF_RF_DEPRECATED_ADDR A:0x678b1070
y.create.l HWIO_BLSP_UART2_UART_DM_TF_RF_2_DEPRECATED_ADDR A:0x678b1074
y.create.l HWIO_BLSP_UART2_UART_DM_TF_RF_3_DEPRECATED_ADDR A:0x678b1078
y.create.l HWIO_BLSP_UART2_UART_DM_TF_RF_4_DEPRECATED_ADDR A:0x678b107c
y.create.l HWIO_BLSP_UART2_UART_DM_SIM_CFG_ADDR A:0x678b1080
y.create.l HWIO_BLSP_UART2_UART_DM_TEST_WR_ADDR_ADDR A:0x678b1084
y.create.l HWIO_BLSP_UART2_UART_DM_TEST_WR_DATA_ADDR A:0x678b1088
y.create.l HWIO_BLSP_UART2_UART_DM_TEST_RD_ADDR_ADDR A:0x678b108c
y.create.l HWIO_BLSP_UART2_UART_DM_TEST_RD_DATA_ADDR A:0x678b1090
y.create.l HWIO_BLSP_UART2_UART_DM_CSR_ADDR A:0x678b10a0
y.create.l HWIO_BLSP_UART2_UART_DM_SR_ADDR A:0x678b10a4
y.create.l HWIO_BLSP_UART2_UART_DM_CR_ADDR A:0x678b10a8
y.create.l HWIO_BLSP_UART2_UART_DM_MISR_ADDR A:0x678b10ac
y.create.l HWIO_BLSP_UART2_UART_DM_IMR_ADDR A:0x678b10b0
y.create.l HWIO_BLSP_UART2_UART_DM_ISR_ADDR A:0x678b10b4
y.create.l HWIO_BLSP_UART2_UART_DM_IRDA_ADDR A:0x678b10b8
y.create.l HWIO_BLSP_UART2_UART_DM_RX_TOTAL_SNAP_ADDR A:0x678b10bc
y.create.l HWIO_BLSP_UART2_UART_DM_WWT_TIMEOUT_ADDR A:0x678b10c0
y.create.l HWIO_BLSP_UART2_UART_DM_CLK_CTRL_ADDR A:0x678b10c4
y.create.l HWIO_BLSP_UART2_UART_DM_BCR_ADDR A:0x678b10c8
y.create.l HWIO_BLSP_UART2_UART_DM_RX_TRANS_CTRL_ADDR A:0x678b10cc
y.create.l HWIO_BLSP_UART2_UART_DM_DMRX_DBG_ADDR A:0x678b10d0
y.create.l HWIO_BLSP_UART2_UART_DM_FSM_STATUS_ADDR A:0x678b10d4
y.create.l HWIO_BLSP_UART2_UART_DM_HW_VERSION_ADDR A:0x678b10d8
y.create.l HWIO_BLSP_UART2_UART_DM_GENERICS_ADDR A:0x678b10dc
y.create.l HWIO_BLSP_UART2_UART_DM_TF_ADDR A:0x678b1100
y.create.l HWIO_BLSP_UART2_UART_DM_TF_2_ADDR A:0x678b1104
y.create.l HWIO_BLSP_UART2_UART_DM_TF_3_ADDR A:0x678b1108
y.create.l HWIO_BLSP_UART2_UART_DM_TF_4_ADDR A:0x678b110c
y.create.l HWIO_BLSP_UART2_UART_DM_TF_5_ADDR A:0x678b1110
y.create.l HWIO_BLSP_UART2_UART_DM_TF_6_ADDR A:0x678b1114
y.create.l HWIO_BLSP_UART2_UART_DM_TF_7_ADDR A:0x678b1118
y.create.l HWIO_BLSP_UART2_UART_DM_TF_8_ADDR A:0x678b111c
y.create.l HWIO_BLSP_UART2_UART_DM_TF_9_ADDR A:0x678b1120
y.create.l HWIO_BLSP_UART2_UART_DM_TF_10_ADDR A:0x678b1124
y.create.l HWIO_BLSP_UART2_UART_DM_TF_11_ADDR A:0x678b1128
y.create.l HWIO_BLSP_UART2_UART_DM_TF_12_ADDR A:0x678b112c
y.create.l HWIO_BLSP_UART2_UART_DM_TF_13_ADDR A:0x678b1130
y.create.l HWIO_BLSP_UART2_UART_DM_TF_14_ADDR A:0x678b1134
y.create.l HWIO_BLSP_UART2_UART_DM_TF_15_ADDR A:0x678b1138
y.create.l HWIO_BLSP_UART2_UART_DM_TF_16_ADDR A:0x678b113c
y.create.l HWIO_BLSP_UART2_UART_DM_RF_ADDR A:0x678b1140
y.create.l HWIO_BLSP_UART2_UART_DM_RF_2_ADDR A:0x678b1144
y.create.l HWIO_BLSP_UART2_UART_DM_RF_3_ADDR A:0x678b1148
y.create.l HWIO_BLSP_UART2_UART_DM_RF_4_ADDR A:0x678b114c
y.create.l HWIO_BLSP_UART2_UART_DM_RF_5_ADDR A:0x678b1150
y.create.l HWIO_BLSP_UART2_UART_DM_RF_6_ADDR A:0x678b1154
y.create.l HWIO_BLSP_UART2_UART_DM_RF_7_ADDR A:0x678b1158
y.create.l HWIO_BLSP_UART2_UART_DM_RF_8_ADDR A:0x678b115c
y.create.l HWIO_BLSP_UART2_UART_DM_RF_9_ADDR A:0x678b1160
y.create.l HWIO_BLSP_UART2_UART_DM_RF_10_ADDR A:0x678b1164
y.create.l HWIO_BLSP_UART2_UART_DM_RF_11_ADDR A:0x678b1168
y.create.l HWIO_BLSP_UART2_UART_DM_RF_12_ADDR A:0x678b116c
y.create.l HWIO_BLSP_UART2_UART_DM_RF_13_ADDR A:0x678b1170
y.create.l HWIO_BLSP_UART2_UART_DM_RF_14_ADDR A:0x678b1174
y.create.l HWIO_BLSP_UART2_UART_DM_RF_15_ADDR A:0x678b1178
y.create.l HWIO_BLSP_UART2_UART_DM_RF_16_ADDR A:0x678b117c
y.create.l HWIO_BLSP_UART2_UART_DM_UIM_CFG_ADDR A:0x678b1180
y.create.l HWIO_BLSP_UART2_UART_DM_UIM_CMD_ADDR A:0x678b1184
y.create.l HWIO_BLSP_UART2_UART_DM_UIM_IO_STATUS_ADDR A:0x678b1188
y.create.l HWIO_BLSP_UART2_UART_DM_UIM_IRQ_ISR_ADDR A:0x678b118c
y.create.l HWIO_BLSP_UART2_UART_DM_UIM_IRQ_MISR_ADDR A:0x678b1190
y.create.l HWIO_BLSP_UART2_UART_DM_UIM_IRQ_CLR_ADDR A:0x678b1194
y.create.l HWIO_BLSP_UART2_UART_DM_UIM_IRQ_IMR_ADDR A:0x678b1198
y.create.l HWIO_BLSP_UART2_UART_DM_UIM_IRQ_IMR_SET_ADDR A:0x678b119c
y.create.l HWIO_BLSP_UART2_UART_DM_UIM_IRQ_IMR_CLR_ADDR A:0x678b11a0
y.create.l HWIO_BLSP_UART3_UART_DM_MR1_ADDR A:0x678b2000
y.create.l HWIO_BLSP_UART3_UART_DM_MR2_ADDR A:0x678b2004
y.create.l HWIO_BLSP_UART3_UART_DM_CSR_SR_DEPRECATED_ADDR A:0x678b2008
y.create.l HWIO_BLSP_UART3_UART_DM_CR_MISR_DEPRECATED_ADDR A:0x678b2010
y.create.l HWIO_BLSP_UART3_UART_DM_IMR_ISR_DEPRECATED_ADDR A:0x678b2014
y.create.l HWIO_BLSP_UART3_UART_DM_IPR_ADDR A:0x678b2018
y.create.l HWIO_BLSP_UART3_UART_DM_TFWR_ADDR A:0x678b201c
y.create.l HWIO_BLSP_UART3_UART_DM_RFWR_ADDR A:0x678b2020
y.create.l HWIO_BLSP_UART3_UART_DM_HCR_ADDR A:0x678b2024
y.create.l HWIO_BLSP_UART3_UART_DM_DMRX_ADDR A:0x678b2034
y.create.l HWIO_BLSP_UART3_UART_DM_IRDA_RX_TOTAL_SNAP_DEPRECATED_ADDR A:0x678b2038
y.create.l HWIO_BLSP_UART3_UART_DM_DMEN_ADDR A:0x678b203c
y.create.l HWIO_BLSP_UART3_UART_DM_NO_CHARS_FOR_TX_ADDR A:0x678b2040
y.create.l HWIO_BLSP_UART3_UART_DM_BADR_ADDR A:0x678b2044
y.create.l HWIO_BLSP_UART3_UART_DM_TESTSL_ADDR A:0x678b2048
y.create.l HWIO_BLSP_UART3_UART_DM_TXFS_ADDR A:0x678b204c
y.create.l HWIO_BLSP_UART3_UART_DM_RXFS_ADDR A:0x678b2050
y.create.l HWIO_BLSP_UART3_UART_DM_MISR_MODE_ADDR A:0x678b2060
y.create.l HWIO_BLSP_UART3_UART_DM_MISR_RESET_ADDR A:0x678b2064
y.create.l HWIO_BLSP_UART3_UART_DM_MISR_EXPORT_ADDR A:0x678b2068
y.create.l HWIO_BLSP_UART3_UART_DM_MISR_VAL_ADDR A:0x678b206c
y.create.l HWIO_BLSP_UART3_UART_DM_TF_RF_DEPRECATED_ADDR A:0x678b2070
y.create.l HWIO_BLSP_UART3_UART_DM_TF_RF_2_DEPRECATED_ADDR A:0x678b2074
y.create.l HWIO_BLSP_UART3_UART_DM_TF_RF_3_DEPRECATED_ADDR A:0x678b2078
y.create.l HWIO_BLSP_UART3_UART_DM_TF_RF_4_DEPRECATED_ADDR A:0x678b207c
y.create.l HWIO_BLSP_UART3_UART_DM_SIM_CFG_ADDR A:0x678b2080
y.create.l HWIO_BLSP_UART3_UART_DM_TEST_WR_ADDR_ADDR A:0x678b2084
y.create.l HWIO_BLSP_UART3_UART_DM_TEST_WR_DATA_ADDR A:0x678b2088
y.create.l HWIO_BLSP_UART3_UART_DM_TEST_RD_ADDR_ADDR A:0x678b208c
y.create.l HWIO_BLSP_UART3_UART_DM_TEST_RD_DATA_ADDR A:0x678b2090
y.create.l HWIO_BLSP_UART3_UART_DM_CSR_ADDR A:0x678b20a0
y.create.l HWIO_BLSP_UART3_UART_DM_SR_ADDR A:0x678b20a4
y.create.l HWIO_BLSP_UART3_UART_DM_CR_ADDR A:0x678b20a8
y.create.l HWIO_BLSP_UART3_UART_DM_MISR_ADDR A:0x678b20ac
y.create.l HWIO_BLSP_UART3_UART_DM_IMR_ADDR A:0x678b20b0
y.create.l HWIO_BLSP_UART3_UART_DM_ISR_ADDR A:0x678b20b4
y.create.l HWIO_BLSP_UART3_UART_DM_IRDA_ADDR A:0x678b20b8
y.create.l HWIO_BLSP_UART3_UART_DM_RX_TOTAL_SNAP_ADDR A:0x678b20bc
y.create.l HWIO_BLSP_UART3_UART_DM_WWT_TIMEOUT_ADDR A:0x678b20c0
y.create.l HWIO_BLSP_UART3_UART_DM_CLK_CTRL_ADDR A:0x678b20c4
y.create.l HWIO_BLSP_UART3_UART_DM_BCR_ADDR A:0x678b20c8
y.create.l HWIO_BLSP_UART3_UART_DM_RX_TRANS_CTRL_ADDR A:0x678b20cc
y.create.l HWIO_BLSP_UART3_UART_DM_DMRX_DBG_ADDR A:0x678b20d0
y.create.l HWIO_BLSP_UART3_UART_DM_FSM_STATUS_ADDR A:0x678b20d4
y.create.l HWIO_BLSP_UART3_UART_DM_HW_VERSION_ADDR A:0x678b20d8
y.create.l HWIO_BLSP_UART3_UART_DM_GENERICS_ADDR A:0x678b20dc
y.create.l HWIO_BLSP_UART3_UART_DM_TF_ADDR A:0x678b2100
y.create.l HWIO_BLSP_UART3_UART_DM_TF_2_ADDR A:0x678b2104
y.create.l HWIO_BLSP_UART3_UART_DM_TF_3_ADDR A:0x678b2108
y.create.l HWIO_BLSP_UART3_UART_DM_TF_4_ADDR A:0x678b210c
y.create.l HWIO_BLSP_UART3_UART_DM_TF_5_ADDR A:0x678b2110
y.create.l HWIO_BLSP_UART3_UART_DM_TF_6_ADDR A:0x678b2114
y.create.l HWIO_BLSP_UART3_UART_DM_TF_7_ADDR A:0x678b2118
y.create.l HWIO_BLSP_UART3_UART_DM_TF_8_ADDR A:0x678b211c
y.create.l HWIO_BLSP_UART3_UART_DM_TF_9_ADDR A:0x678b2120
y.create.l HWIO_BLSP_UART3_UART_DM_TF_10_ADDR A:0x678b2124
y.create.l HWIO_BLSP_UART3_UART_DM_TF_11_ADDR A:0x678b2128
y.create.l HWIO_BLSP_UART3_UART_DM_TF_12_ADDR A:0x678b212c
y.create.l HWIO_BLSP_UART3_UART_DM_TF_13_ADDR A:0x678b2130
y.create.l HWIO_BLSP_UART3_UART_DM_TF_14_ADDR A:0x678b2134
y.create.l HWIO_BLSP_UART3_UART_DM_TF_15_ADDR A:0x678b2138
y.create.l HWIO_BLSP_UART3_UART_DM_TF_16_ADDR A:0x678b213c
y.create.l HWIO_BLSP_UART3_UART_DM_RF_ADDR A:0x678b2140
y.create.l HWIO_BLSP_UART3_UART_DM_RF_2_ADDR A:0x678b2144
y.create.l HWIO_BLSP_UART3_UART_DM_RF_3_ADDR A:0x678b2148
y.create.l HWIO_BLSP_UART3_UART_DM_RF_4_ADDR A:0x678b214c
y.create.l HWIO_BLSP_UART3_UART_DM_RF_5_ADDR A:0x678b2150
y.create.l HWIO_BLSP_UART3_UART_DM_RF_6_ADDR A:0x678b2154
y.create.l HWIO_BLSP_UART3_UART_DM_RF_7_ADDR A:0x678b2158
y.create.l HWIO_BLSP_UART3_UART_DM_RF_8_ADDR A:0x678b215c
y.create.l HWIO_BLSP_UART3_UART_DM_RF_9_ADDR A:0x678b2160
y.create.l HWIO_BLSP_UART3_UART_DM_RF_10_ADDR A:0x678b2164
y.create.l HWIO_BLSP_UART3_UART_DM_RF_11_ADDR A:0x678b2168
y.create.l HWIO_BLSP_UART3_UART_DM_RF_12_ADDR A:0x678b216c
y.create.l HWIO_BLSP_UART3_UART_DM_RF_13_ADDR A:0x678b2170
y.create.l HWIO_BLSP_UART3_UART_DM_RF_14_ADDR A:0x678b2174
y.create.l HWIO_BLSP_UART3_UART_DM_RF_15_ADDR A:0x678b2178
y.create.l HWIO_BLSP_UART3_UART_DM_RF_16_ADDR A:0x678b217c
y.create.l HWIO_BLSP_UART3_UART_DM_UIM_CFG_ADDR A:0x678b2180
y.create.l HWIO_BLSP_UART3_UART_DM_UIM_CMD_ADDR A:0x678b2184
y.create.l HWIO_BLSP_UART3_UART_DM_UIM_IO_STATUS_ADDR A:0x678b2188
y.create.l HWIO_BLSP_UART3_UART_DM_UIM_IRQ_ISR_ADDR A:0x678b218c
y.create.l HWIO_BLSP_UART3_UART_DM_UIM_IRQ_MISR_ADDR A:0x678b2190
y.create.l HWIO_BLSP_UART3_UART_DM_UIM_IRQ_CLR_ADDR A:0x678b2194
y.create.l HWIO_BLSP_UART3_UART_DM_UIM_IRQ_IMR_ADDR A:0x678b2198
y.create.l HWIO_BLSP_UART3_UART_DM_UIM_IRQ_IMR_SET_ADDR A:0x678b219c
y.create.l HWIO_BLSP_UART3_UART_DM_UIM_IRQ_IMR_CLR_ADDR A:0x678b21a0
y.create.l HWIO_BLSP_QUP0_QUP_CONFIG_ADDR A:0x678b5000
y.create.l HWIO_BLSP_QUP0_QUP_STATE_ADDR A:0x678b5004
y.create.l HWIO_BLSP_QUP0_QUP_IO_MODES_ADDR A:0x678b5008
y.create.l HWIO_BLSP_QUP0_QUP_SW_RESET_ADDR A:0x678b500c
y.create.l HWIO_BLSP_QUP0_QUP_TRANSFER_CANCEL_ADDR A:0x678b5014
y.create.l HWIO_BLSP_QUP0_QUP_OPERATIONAL_ADDR A:0x678b5018
y.create.l HWIO_BLSP_QUP0_QUP_ERROR_FLAGS_ADDR A:0x678b501c
y.create.l HWIO_BLSP_QUP0_QUP_ERROR_FLAGS_EN_ADDR A:0x678b5020
y.create.l HWIO_BLSP_QUP0_QUP_TEST_CTRL_ADDR A:0x678b5024
y.create.l HWIO_BLSP_QUP0_QUP_OPERATIONAL_MASK_ADDR A:0x678b5028
y.create.l HWIO_BLSP_QUP0_QUP_HW_VERSION_ADDR A:0x678b5030
y.create.l HWIO_BLSP_QUP0_QUP_MX_OUTPUT_COUNT_ADDR A:0x678b5100
y.create.l HWIO_BLSP_QUP0_QUP_MX_OUTPUT_CNT_CURRENT_ADDR A:0x678b5104
y.create.l HWIO_BLSP_QUP0_QUP_OUTPUT_DEBUG_ADDR A:0x678b5108
y.create.l HWIO_BLSP_QUP0_QUP_OUTPUT_FIFO_WORD_CNT_ADDR A:0x678b510c
y.create.l HWIO_BLSP_QUP0_QUP_OUTPUT_FIFO0_ADDR A:0x678b5110
y.create.l HWIO_BLSP_QUP0_QUP_OUTPUT_FIFO1_ADDR A:0x678b5114
y.create.l HWIO_BLSP_QUP0_QUP_OUTPUT_FIFO2_ADDR A:0x678b5118
y.create.l HWIO_BLSP_QUP0_QUP_OUTPUT_FIFO3_ADDR A:0x678b511c
y.create.l HWIO_BLSP_QUP0_QUP_OUTPUT_FIFO4_ADDR A:0x678b5120
y.create.l HWIO_BLSP_QUP0_QUP_OUTPUT_FIFO5_ADDR A:0x678b5124
y.create.l HWIO_BLSP_QUP0_QUP_OUTPUT_FIFO6_ADDR A:0x678b5128
y.create.l HWIO_BLSP_QUP0_QUP_OUTPUT_FIFO7_ADDR A:0x678b512c
y.create.l HWIO_BLSP_QUP0_QUP_OUTPUT_FIFO8_ADDR A:0x678b5130
y.create.l HWIO_BLSP_QUP0_QUP_OUTPUT_FIFO9_ADDR A:0x678b5134
y.create.l HWIO_BLSP_QUP0_QUP_MX_WRITE_COUNT_ADDR A:0x678b5150
y.create.l HWIO_BLSP_QUP0_QUP_MX_WRITE_CNT_CURRENT_ADDR A:0x678b5154
y.create.l HWIO_BLSP_QUP0_QUP_MX_INPUT_COUNT_ADDR A:0x678b5200
y.create.l HWIO_BLSP_QUP0_QUP_MX_INPUT_CNT_CURRENT_ADDR A:0x678b5204
y.create.l HWIO_BLSP_QUP0_QUP_MX_READ_COUNT_ADDR A:0x678b5208
y.create.l HWIO_BLSP_QUP0_QUP_MX_READ_CNT_CURRENT_ADDR A:0x678b520c
y.create.l HWIO_BLSP_QUP0_QUP_INPUT_DEBUG_ADDR A:0x678b5210
y.create.l HWIO_BLSP_QUP0_QUP_INPUT_FIFO_WORD_CNT_ADDR A:0x678b5214
y.create.l HWIO_BLSP_QUP0_QUP_INPUT_FIFO0_ADDR A:0x678b5218
y.create.l HWIO_BLSP_QUP0_QUP_INPUT_FIFO1_ADDR A:0x678b521c
y.create.l HWIO_BLSP_QUP0_QUP_INPUT_FIFO2_ADDR A:0x678b5220
y.create.l HWIO_BLSP_QUP0_QUP_INPUT_FIFO3_ADDR A:0x678b5224
y.create.l HWIO_BLSP_QUP0_QUP_INPUT_FIFO4_ADDR A:0x678b5228
y.create.l HWIO_BLSP_QUP0_QUP_INPUT_FIFO5_ADDR A:0x678b522c
y.create.l HWIO_BLSP_QUP0_QUP_INPUT_FIFO6_ADDR A:0x678b5230
y.create.l HWIO_BLSP_QUP0_QUP_INPUT_FIFO7_ADDR A:0x678b5234
y.create.l HWIO_BLSP_QUP0_QUP_INPUT_FIFO8_ADDR A:0x678b5238
y.create.l HWIO_BLSP_QUP0_QUP_INPUT_FIFO9_ADDR A:0x678b523c
y.create.l HWIO_BLSP_QUP0_SPI_CONFIG_ADDR A:0x678b5300
y.create.l HWIO_BLSP_QUP0_SPI_IO_CONTROL_ADDR A:0x678b5304
y.create.l HWIO_BLSP_QUP0_SPI_ERROR_FLAGS_ADDR A:0x678b5308
y.create.l HWIO_BLSP_QUP0_SPI_ERROR_FLAGS_EN_ADDR A:0x678b530c
y.create.l HWIO_BLSP_QUP0_SPI_DEASSERT_WAIT_ADDR A:0x678b5310
y.create.l HWIO_BLSP_QUP0_SPI_MASTER_LOCAL_ID_ADDR A:0x678b5314
y.create.l HWIO_BLSP_QUP0_SPI_MASTER_COMMAND_ADDR A:0x678b5318
y.create.l HWIO_BLSP_QUP0_SPI_MASTER_STATUS_ADDR A:0x678b531c
y.create.l HWIO_BLSP_QUP0_SPI_CHAR_CFG_ADDR A:0x678b5320
y.create.l HWIO_BLSP_QUP0_SPI_CHAR_DATA_SPI_CS_ADDR A:0x678b5324
y.create.l HWIO_BLSP_QUP0_SPI_CHAR_DATA_SPI_MOSI_ADDR A:0x678b5328
y.create.l HWIO_BLSP_QUP0_SPI_CHAR_DATA_SPI_MISO_ADDR A:0x678b532c
y.create.l HWIO_BLSP_QUP0_I2C_MASTER_CLK_CTL_ADDR A:0x678b5400
y.create.l HWIO_BLSP_QUP0_I2C_MASTER_STATUS_ADDR A:0x678b5404
y.create.l HWIO_BLSP_QUP0_I2C_MASTER_CONFIG_ADDR A:0x678b5408
y.create.l HWIO_BLSP_QUP0_I2C_MASTER_BUS_CLEAR_ADDR A:0x678b540c
y.create.l HWIO_BLSP_QUP0_I2C_MASTER_LOCAL_ID_ADDR A:0x678b5410
y.create.l HWIO_BLSP_QUP0_I2C_MASTER_COMMAND_ADDR A:0x678b5414
y.create.l HWIO_BLSP_QUP1_QUP_CONFIG_ADDR A:0x678b6000
y.create.l HWIO_BLSP_QUP1_QUP_STATE_ADDR A:0x678b6004
y.create.l HWIO_BLSP_QUP1_QUP_IO_MODES_ADDR A:0x678b6008
y.create.l HWIO_BLSP_QUP1_QUP_SW_RESET_ADDR A:0x678b600c
y.create.l HWIO_BLSP_QUP1_QUP_TRANSFER_CANCEL_ADDR A:0x678b6014
y.create.l HWIO_BLSP_QUP1_QUP_OPERATIONAL_ADDR A:0x678b6018
y.create.l HWIO_BLSP_QUP1_QUP_ERROR_FLAGS_ADDR A:0x678b601c
y.create.l HWIO_BLSP_QUP1_QUP_ERROR_FLAGS_EN_ADDR A:0x678b6020
y.create.l HWIO_BLSP_QUP1_QUP_TEST_CTRL_ADDR A:0x678b6024
y.create.l HWIO_BLSP_QUP1_QUP_OPERATIONAL_MASK_ADDR A:0x678b6028
y.create.l HWIO_BLSP_QUP1_QUP_HW_VERSION_ADDR A:0x678b6030
y.create.l HWIO_BLSP_QUP1_QUP_MX_OUTPUT_COUNT_ADDR A:0x678b6100
y.create.l HWIO_BLSP_QUP1_QUP_MX_OUTPUT_CNT_CURRENT_ADDR A:0x678b6104
y.create.l HWIO_BLSP_QUP1_QUP_OUTPUT_DEBUG_ADDR A:0x678b6108
y.create.l HWIO_BLSP_QUP1_QUP_OUTPUT_FIFO_WORD_CNT_ADDR A:0x678b610c
y.create.l HWIO_BLSP_QUP1_QUP_OUTPUT_FIFO0_ADDR A:0x678b6110
y.create.l HWIO_BLSP_QUP1_QUP_OUTPUT_FIFO1_ADDR A:0x678b6114
y.create.l HWIO_BLSP_QUP1_QUP_OUTPUT_FIFO2_ADDR A:0x678b6118
y.create.l HWIO_BLSP_QUP1_QUP_OUTPUT_FIFO3_ADDR A:0x678b611c
y.create.l HWIO_BLSP_QUP1_QUP_OUTPUT_FIFO4_ADDR A:0x678b6120
y.create.l HWIO_BLSP_QUP1_QUP_OUTPUT_FIFO5_ADDR A:0x678b6124
y.create.l HWIO_BLSP_QUP1_QUP_OUTPUT_FIFO6_ADDR A:0x678b6128
y.create.l HWIO_BLSP_QUP1_QUP_OUTPUT_FIFO7_ADDR A:0x678b612c
y.create.l HWIO_BLSP_QUP1_QUP_OUTPUT_FIFO8_ADDR A:0x678b6130
y.create.l HWIO_BLSP_QUP1_QUP_OUTPUT_FIFO9_ADDR A:0x678b6134
y.create.l HWIO_BLSP_QUP1_QUP_MX_WRITE_COUNT_ADDR A:0x678b6150
y.create.l HWIO_BLSP_QUP1_QUP_MX_WRITE_CNT_CURRENT_ADDR A:0x678b6154
y.create.l HWIO_BLSP_QUP1_QUP_MX_INPUT_COUNT_ADDR A:0x678b6200
y.create.l HWIO_BLSP_QUP1_QUP_MX_INPUT_CNT_CURRENT_ADDR A:0x678b6204
y.create.l HWIO_BLSP_QUP1_QUP_MX_READ_COUNT_ADDR A:0x678b6208
y.create.l HWIO_BLSP_QUP1_QUP_MX_READ_CNT_CURRENT_ADDR A:0x678b620c
y.create.l HWIO_BLSP_QUP1_QUP_INPUT_DEBUG_ADDR A:0x678b6210
y.create.l HWIO_BLSP_QUP1_QUP_INPUT_FIFO_WORD_CNT_ADDR A:0x678b6214
y.create.l HWIO_BLSP_QUP1_QUP_INPUT_FIFO0_ADDR A:0x678b6218
y.create.l HWIO_BLSP_QUP1_QUP_INPUT_FIFO1_ADDR A:0x678b621c
y.create.l HWIO_BLSP_QUP1_QUP_INPUT_FIFO2_ADDR A:0x678b6220
y.create.l HWIO_BLSP_QUP1_QUP_INPUT_FIFO3_ADDR A:0x678b6224
y.create.l HWIO_BLSP_QUP1_QUP_INPUT_FIFO4_ADDR A:0x678b6228
y.create.l HWIO_BLSP_QUP1_QUP_INPUT_FIFO5_ADDR A:0x678b622c
y.create.l HWIO_BLSP_QUP1_QUP_INPUT_FIFO6_ADDR A:0x678b6230
y.create.l HWIO_BLSP_QUP1_QUP_INPUT_FIFO7_ADDR A:0x678b6234
y.create.l HWIO_BLSP_QUP1_QUP_INPUT_FIFO8_ADDR A:0x678b6238
y.create.l HWIO_BLSP_QUP1_QUP_INPUT_FIFO9_ADDR A:0x678b623c
y.create.l HWIO_BLSP_QUP1_SPI_CONFIG_ADDR A:0x678b6300
y.create.l HWIO_BLSP_QUP1_SPI_IO_CONTROL_ADDR A:0x678b6304
y.create.l HWIO_BLSP_QUP1_SPI_ERROR_FLAGS_ADDR A:0x678b6308
y.create.l HWIO_BLSP_QUP1_SPI_ERROR_FLAGS_EN_ADDR A:0x678b630c
y.create.l HWIO_BLSP_QUP1_SPI_DEASSERT_WAIT_ADDR A:0x678b6310
y.create.l HWIO_BLSP_QUP1_SPI_MASTER_LOCAL_ID_ADDR A:0x678b6314
y.create.l HWIO_BLSP_QUP1_SPI_MASTER_COMMAND_ADDR A:0x678b6318
y.create.l HWIO_BLSP_QUP1_SPI_MASTER_STATUS_ADDR A:0x678b631c
y.create.l HWIO_BLSP_QUP1_SPI_CHAR_CFG_ADDR A:0x678b6320
y.create.l HWIO_BLSP_QUP1_SPI_CHAR_DATA_SPI_CS_ADDR A:0x678b6324
y.create.l HWIO_BLSP_QUP1_SPI_CHAR_DATA_SPI_MOSI_ADDR A:0x678b6328
y.create.l HWIO_BLSP_QUP1_SPI_CHAR_DATA_SPI_MISO_ADDR A:0x678b632c
y.create.l HWIO_BLSP_QUP1_I2C_MASTER_CLK_CTL_ADDR A:0x678b6400
y.create.l HWIO_BLSP_QUP1_I2C_MASTER_STATUS_ADDR A:0x678b6404
y.create.l HWIO_BLSP_QUP1_I2C_MASTER_CONFIG_ADDR A:0x678b6408
y.create.l HWIO_BLSP_QUP1_I2C_MASTER_BUS_CLEAR_ADDR A:0x678b640c
y.create.l HWIO_BLSP_QUP1_I2C_MASTER_LOCAL_ID_ADDR A:0x678b6410
y.create.l HWIO_BLSP_QUP1_I2C_MASTER_COMMAND_ADDR A:0x678b6414
y.create.l HWIO_BLSP_QUP2_QUP_CONFIG_ADDR A:0x678b7000
y.create.l HWIO_BLSP_QUP2_QUP_STATE_ADDR A:0x678b7004
y.create.l HWIO_BLSP_QUP2_QUP_IO_MODES_ADDR A:0x678b7008
y.create.l HWIO_BLSP_QUP2_QUP_SW_RESET_ADDR A:0x678b700c
y.create.l HWIO_BLSP_QUP2_QUP_TRANSFER_CANCEL_ADDR A:0x678b7014
y.create.l HWIO_BLSP_QUP2_QUP_OPERATIONAL_ADDR A:0x678b7018
y.create.l HWIO_BLSP_QUP2_QUP_ERROR_FLAGS_ADDR A:0x678b701c
y.create.l HWIO_BLSP_QUP2_QUP_ERROR_FLAGS_EN_ADDR A:0x678b7020
y.create.l HWIO_BLSP_QUP2_QUP_TEST_CTRL_ADDR A:0x678b7024
y.create.l HWIO_BLSP_QUP2_QUP_OPERATIONAL_MASK_ADDR A:0x678b7028
y.create.l HWIO_BLSP_QUP2_QUP_HW_VERSION_ADDR A:0x678b7030
y.create.l HWIO_BLSP_QUP2_QUP_MX_OUTPUT_COUNT_ADDR A:0x678b7100
y.create.l HWIO_BLSP_QUP2_QUP_MX_OUTPUT_CNT_CURRENT_ADDR A:0x678b7104
y.create.l HWIO_BLSP_QUP2_QUP_OUTPUT_DEBUG_ADDR A:0x678b7108
y.create.l HWIO_BLSP_QUP2_QUP_OUTPUT_FIFO_WORD_CNT_ADDR A:0x678b710c
y.create.l HWIO_BLSP_QUP2_QUP_OUTPUT_FIFO0_ADDR A:0x678b7110
y.create.l HWIO_BLSP_QUP2_QUP_OUTPUT_FIFO1_ADDR A:0x678b7114
y.create.l HWIO_BLSP_QUP2_QUP_OUTPUT_FIFO2_ADDR A:0x678b7118
y.create.l HWIO_BLSP_QUP2_QUP_OUTPUT_FIFO3_ADDR A:0x678b711c
y.create.l HWIO_BLSP_QUP2_QUP_OUTPUT_FIFO4_ADDR A:0x678b7120
y.create.l HWIO_BLSP_QUP2_QUP_OUTPUT_FIFO5_ADDR A:0x678b7124
y.create.l HWIO_BLSP_QUP2_QUP_OUTPUT_FIFO6_ADDR A:0x678b7128
y.create.l HWIO_BLSP_QUP2_QUP_OUTPUT_FIFO7_ADDR A:0x678b712c
y.create.l HWIO_BLSP_QUP2_QUP_OUTPUT_FIFO8_ADDR A:0x678b7130
y.create.l HWIO_BLSP_QUP2_QUP_OUTPUT_FIFO9_ADDR A:0x678b7134
y.create.l HWIO_BLSP_QUP2_QUP_MX_WRITE_COUNT_ADDR A:0x678b7150
y.create.l HWIO_BLSP_QUP2_QUP_MX_WRITE_CNT_CURRENT_ADDR A:0x678b7154
y.create.l HWIO_BLSP_QUP2_QUP_MX_INPUT_COUNT_ADDR A:0x678b7200
y.create.l HWIO_BLSP_QUP2_QUP_MX_INPUT_CNT_CURRENT_ADDR A:0x678b7204
y.create.l HWIO_BLSP_QUP2_QUP_MX_READ_COUNT_ADDR A:0x678b7208
y.create.l HWIO_BLSP_QUP2_QUP_MX_READ_CNT_CURRENT_ADDR A:0x678b720c
y.create.l HWIO_BLSP_QUP2_QUP_INPUT_DEBUG_ADDR A:0x678b7210
y.create.l HWIO_BLSP_QUP2_QUP_INPUT_FIFO_WORD_CNT_ADDR A:0x678b7214
y.create.l HWIO_BLSP_QUP2_QUP_INPUT_FIFO0_ADDR A:0x678b7218
y.create.l HWIO_BLSP_QUP2_QUP_INPUT_FIFO1_ADDR A:0x678b721c
y.create.l HWIO_BLSP_QUP2_QUP_INPUT_FIFO2_ADDR A:0x678b7220
y.create.l HWIO_BLSP_QUP2_QUP_INPUT_FIFO3_ADDR A:0x678b7224
y.create.l HWIO_BLSP_QUP2_QUP_INPUT_FIFO4_ADDR A:0x678b7228
y.create.l HWIO_BLSP_QUP2_QUP_INPUT_FIFO5_ADDR A:0x678b722c
y.create.l HWIO_BLSP_QUP2_QUP_INPUT_FIFO6_ADDR A:0x678b7230
y.create.l HWIO_BLSP_QUP2_QUP_INPUT_FIFO7_ADDR A:0x678b7234
y.create.l HWIO_BLSP_QUP2_QUP_INPUT_FIFO8_ADDR A:0x678b7238
y.create.l HWIO_BLSP_QUP2_QUP_INPUT_FIFO9_ADDR A:0x678b723c
y.create.l HWIO_BLSP_QUP2_SPI_CONFIG_ADDR A:0x678b7300
y.create.l HWIO_BLSP_QUP2_SPI_IO_CONTROL_ADDR A:0x678b7304
y.create.l HWIO_BLSP_QUP2_SPI_ERROR_FLAGS_ADDR A:0x678b7308
y.create.l HWIO_BLSP_QUP2_SPI_ERROR_FLAGS_EN_ADDR A:0x678b730c
y.create.l HWIO_BLSP_QUP2_SPI_DEASSERT_WAIT_ADDR A:0x678b7310
y.create.l HWIO_BLSP_QUP2_SPI_MASTER_LOCAL_ID_ADDR A:0x678b7314
y.create.l HWIO_BLSP_QUP2_SPI_MASTER_COMMAND_ADDR A:0x678b7318
y.create.l HWIO_BLSP_QUP2_SPI_MASTER_STATUS_ADDR A:0x678b731c
y.create.l HWIO_BLSP_QUP2_SPI_CHAR_CFG_ADDR A:0x678b7320
y.create.l HWIO_BLSP_QUP2_SPI_CHAR_DATA_SPI_CS_ADDR A:0x678b7324
y.create.l HWIO_BLSP_QUP2_SPI_CHAR_DATA_SPI_MOSI_ADDR A:0x678b7328
y.create.l HWIO_BLSP_QUP2_SPI_CHAR_DATA_SPI_MISO_ADDR A:0x678b732c
y.create.l HWIO_BLSP_QUP2_I2C_MASTER_CLK_CTL_ADDR A:0x678b7400
y.create.l HWIO_BLSP_QUP2_I2C_MASTER_STATUS_ADDR A:0x678b7404
y.create.l HWIO_BLSP_QUP2_I2C_MASTER_CONFIG_ADDR A:0x678b7408
y.create.l HWIO_BLSP_QUP2_I2C_MASTER_BUS_CLEAR_ADDR A:0x678b740c
y.create.l HWIO_BLSP_QUP2_I2C_MASTER_LOCAL_ID_ADDR A:0x678b7410
y.create.l HWIO_BLSP_QUP2_I2C_MASTER_COMMAND_ADDR A:0x678b7414
y.create.l HWIO_BLSP_QUP3_QUP_CONFIG_ADDR A:0x678b8000
y.create.l HWIO_BLSP_QUP3_QUP_STATE_ADDR A:0x678b8004
y.create.l HWIO_BLSP_QUP3_QUP_IO_MODES_ADDR A:0x678b8008
y.create.l HWIO_BLSP_QUP3_QUP_SW_RESET_ADDR A:0x678b800c
y.create.l HWIO_BLSP_QUP3_QUP_TRANSFER_CANCEL_ADDR A:0x678b8014
y.create.l HWIO_BLSP_QUP3_QUP_OPERATIONAL_ADDR A:0x678b8018
y.create.l HWIO_BLSP_QUP3_QUP_ERROR_FLAGS_ADDR A:0x678b801c
y.create.l HWIO_BLSP_QUP3_QUP_ERROR_FLAGS_EN_ADDR A:0x678b8020
y.create.l HWIO_BLSP_QUP3_QUP_TEST_CTRL_ADDR A:0x678b8024
y.create.l HWIO_BLSP_QUP3_QUP_OPERATIONAL_MASK_ADDR A:0x678b8028
y.create.l HWIO_BLSP_QUP3_QUP_HW_VERSION_ADDR A:0x678b8030
y.create.l HWIO_BLSP_QUP3_QUP_MX_OUTPUT_COUNT_ADDR A:0x678b8100
y.create.l HWIO_BLSP_QUP3_QUP_MX_OUTPUT_CNT_CURRENT_ADDR A:0x678b8104
y.create.l HWIO_BLSP_QUP3_QUP_OUTPUT_DEBUG_ADDR A:0x678b8108
y.create.l HWIO_BLSP_QUP3_QUP_OUTPUT_FIFO_WORD_CNT_ADDR A:0x678b810c
y.create.l HWIO_BLSP_QUP3_QUP_OUTPUT_FIFO0_ADDR A:0x678b8110
y.create.l HWIO_BLSP_QUP3_QUP_OUTPUT_FIFO1_ADDR A:0x678b8114
y.create.l HWIO_BLSP_QUP3_QUP_OUTPUT_FIFO2_ADDR A:0x678b8118
y.create.l HWIO_BLSP_QUP3_QUP_OUTPUT_FIFO3_ADDR A:0x678b811c
y.create.l HWIO_BLSP_QUP3_QUP_OUTPUT_FIFO4_ADDR A:0x678b8120
y.create.l HWIO_BLSP_QUP3_QUP_OUTPUT_FIFO5_ADDR A:0x678b8124
y.create.l HWIO_BLSP_QUP3_QUP_OUTPUT_FIFO6_ADDR A:0x678b8128
y.create.l HWIO_BLSP_QUP3_QUP_OUTPUT_FIFO7_ADDR A:0x678b812c
y.create.l HWIO_BLSP_QUP3_QUP_OUTPUT_FIFO8_ADDR A:0x678b8130
y.create.l HWIO_BLSP_QUP3_QUP_OUTPUT_FIFO9_ADDR A:0x678b8134
y.create.l HWIO_BLSP_QUP3_QUP_MX_WRITE_COUNT_ADDR A:0x678b8150
y.create.l HWIO_BLSP_QUP3_QUP_MX_WRITE_CNT_CURRENT_ADDR A:0x678b8154
y.create.l HWIO_BLSP_QUP3_QUP_MX_INPUT_COUNT_ADDR A:0x678b8200
y.create.l HWIO_BLSP_QUP3_QUP_MX_INPUT_CNT_CURRENT_ADDR A:0x678b8204
y.create.l HWIO_BLSP_QUP3_QUP_MX_READ_COUNT_ADDR A:0x678b8208
y.create.l HWIO_BLSP_QUP3_QUP_MX_READ_CNT_CURRENT_ADDR A:0x678b820c
y.create.l HWIO_BLSP_QUP3_QUP_INPUT_DEBUG_ADDR A:0x678b8210
y.create.l HWIO_BLSP_QUP3_QUP_INPUT_FIFO_WORD_CNT_ADDR A:0x678b8214
y.create.l HWIO_BLSP_QUP3_QUP_INPUT_FIFO0_ADDR A:0x678b8218
y.create.l HWIO_BLSP_QUP3_QUP_INPUT_FIFO1_ADDR A:0x678b821c
y.create.l HWIO_BLSP_QUP3_QUP_INPUT_FIFO2_ADDR A:0x678b8220
y.create.l HWIO_BLSP_QUP3_QUP_INPUT_FIFO3_ADDR A:0x678b8224
y.create.l HWIO_BLSP_QUP3_QUP_INPUT_FIFO4_ADDR A:0x678b8228
y.create.l HWIO_BLSP_QUP3_QUP_INPUT_FIFO5_ADDR A:0x678b822c
y.create.l HWIO_BLSP_QUP3_QUP_INPUT_FIFO6_ADDR A:0x678b8230
y.create.l HWIO_BLSP_QUP3_QUP_INPUT_FIFO7_ADDR A:0x678b8234
y.create.l HWIO_BLSP_QUP3_QUP_INPUT_FIFO8_ADDR A:0x678b8238
y.create.l HWIO_BLSP_QUP3_QUP_INPUT_FIFO9_ADDR A:0x678b823c
y.create.l HWIO_BLSP_QUP3_SPI_CONFIG_ADDR A:0x678b8300
y.create.l HWIO_BLSP_QUP3_SPI_IO_CONTROL_ADDR A:0x678b8304
y.create.l HWIO_BLSP_QUP3_SPI_ERROR_FLAGS_ADDR A:0x678b8308
y.create.l HWIO_BLSP_QUP3_SPI_ERROR_FLAGS_EN_ADDR A:0x678b830c
y.create.l HWIO_BLSP_QUP3_SPI_DEASSERT_WAIT_ADDR A:0x678b8310
y.create.l HWIO_BLSP_QUP3_SPI_MASTER_LOCAL_ID_ADDR A:0x678b8314
y.create.l HWIO_BLSP_QUP3_SPI_MASTER_COMMAND_ADDR A:0x678b8318
y.create.l HWIO_BLSP_QUP3_SPI_MASTER_STATUS_ADDR A:0x678b831c
y.create.l HWIO_BLSP_QUP3_SPI_CHAR_CFG_ADDR A:0x678b8320
y.create.l HWIO_BLSP_QUP3_SPI_CHAR_DATA_SPI_CS_ADDR A:0x678b8324
y.create.l HWIO_BLSP_QUP3_SPI_CHAR_DATA_SPI_MOSI_ADDR A:0x678b8328
y.create.l HWIO_BLSP_QUP3_SPI_CHAR_DATA_SPI_MISO_ADDR A:0x678b832c
y.create.l HWIO_BLSP_QUP3_I2C_MASTER_CLK_CTL_ADDR A:0x678b8400
y.create.l HWIO_BLSP_QUP3_I2C_MASTER_STATUS_ADDR A:0x678b8404
y.create.l HWIO_BLSP_QUP3_I2C_MASTER_CONFIG_ADDR A:0x678b8408
y.create.l HWIO_BLSP_QUP3_I2C_MASTER_BUS_CLEAR_ADDR A:0x678b840c
y.create.l HWIO_BLSP_QUP3_I2C_MASTER_LOCAL_ID_ADDR A:0x678b8410
y.create.l HWIO_BLSP_QUP3_I2C_MASTER_COMMAND_ADDR A:0x678b8414
y.create.l HWIO_BOOT_ROM_XPU_SCR_ADDR A:0x601ff000
y.create.l HWIO_BOOT_ROM_XPU_SWDR_ADDR A:0x601ff004
y.create.l HWIO_BOOT_ROM_XPU_PRTN_RACR_SSHADOW_ADDR A:0x601ff008
y.create.l HWIO_BOOT_ROM_XPU_PRTN_START_SSHADOW0_ADDR A:0x601ff010
y.create.l HWIO_BOOT_ROM_XPU_PRTN_END_SSHADOW0_ADDR A:0x601ff018
y.create.l HWIO_BOOT_ROM_XPU_SEAR0_ADDR A:0x601ff040
y.create.l HWIO_BOOT_ROM_XPU_SESR_ADDR A:0x601ff048
y.create.l HWIO_BOOT_ROM_XPU_SESRRESTORE_ADDR A:0x601ff04c
y.create.l HWIO_BOOT_ROM_XPU_SESYNR0_ADDR A:0x601ff050
y.create.l HWIO_BOOT_ROM_XPU_SESYNR1_ADDR A:0x601ff054
y.create.l HWIO_BOOT_ROM_XPU_SESYNR2_ADDR A:0x601ff058
y.create.l HWIO_BOOT_ROM_XPU_MCR_ADDR A:0x601ff100
y.create.l HWIO_BOOT_ROM_XPU_MEAR0_ADDR A:0x601ff140
y.create.l HWIO_BOOT_ROM_XPU_MESR_ADDR A:0x601ff148
y.create.l HWIO_BOOT_ROM_XPU_MESRRESTORE_ADDR A:0x601ff14c
y.create.l HWIO_BOOT_ROM_XPU_MESYNR0_ADDR A:0x601ff150
y.create.l HWIO_BOOT_ROM_XPU_MESYNR1_ADDR A:0x601ff154
y.create.l HWIO_BOOT_ROM_XPU_MESYNR2_ADDR A:0x601ff158
y.create.l HWIO_BOOT_ROM_XPU_CR_ADDR A:0x601ff080
y.create.l HWIO_BOOT_ROM_XPU_PRTN_RACR_SHADOW_ADDR A:0x601ff088
y.create.l HWIO_BOOT_ROM_XPU_PRTN_START_SHADOW0_ADDR A:0x601ff090
y.create.l HWIO_BOOT_ROM_XPU_PRTN_END_SHADOW0_ADDR A:0x601ff098
y.create.l HWIO_BOOT_ROM_XPU_RPU_ACR0_ADDR A:0x601ff0a0
y.create.l HWIO_BOOT_ROM_XPU_EAR0_ADDR A:0x601ff0c0
y.create.l HWIO_BOOT_ROM_XPU_ESR_ADDR A:0x601ff0c8
y.create.l HWIO_BOOT_ROM_XPU_ESRRESTORE_ADDR A:0x601ff0cc
y.create.l HWIO_BOOT_ROM_XPU_ESYNR0_ADDR A:0x601ff0d0
y.create.l HWIO_BOOT_ROM_XPU_ESYNR1_ADDR A:0x601ff0d4
y.create.l HWIO_BOOT_ROM_XPU_ESYNR2_ADDR A:0x601ff0d8
y.create.l HWIO_BOOT_ROM_XPU_UMR_RACR_ADDR A:0x601ff0e0
y.create.l HWIO_BOOT_ROM_XPU_UMR_WACR_ADDR A:0x601ff0e4
y.create.l HWIO_BOOT_ROM_XPU_UMR_CNTL_ADDR A:0x601ff0f0
y.create.l HWIO_BOOT_ROM_XPU_IDR0_ADDR A:0x601ff074
y.create.l HWIO_BOOT_ROM_XPU_IDR1_ADDR A:0x601ff078
y.create.l HWIO_BOOT_ROM_XPU_REV_ADDR A:0x601ff07c
y.create.l HWIO_BOOT_ROM_XPU_PRT0_RACR0_ADDR A:0x601ff200
y.create.l HWIO_BOOT_ROM_XPU_PRT1_RACR0_ADDR A:0x601ff280
y.create.l HWIO_BOOT_ROM_XPU_PRT2_RACR0_ADDR A:0x601ff300
y.create.l HWIO_BOOT_ROM_XPU_PRT0_START0_ADDR A:0x601ff240
y.create.l HWIO_BOOT_ROM_XPU_PRT1_START0_ADDR A:0x601ff2c0
y.create.l HWIO_BOOT_ROM_XPU_PRT2_START0_ADDR A:0x601ff340
y.create.l HWIO_BOOT_ROM_XPU_PRT0_END0_ADDR A:0x601ff248
y.create.l HWIO_BOOT_ROM_XPU_PRT1_END0_ADDR A:0x601ff2c8
y.create.l HWIO_BOOT_ROM_XPU_PRT2_END0_ADDR A:0x601ff348
y.create.l HWIO_BOOT_ROM_XPU_PRT0_SCR_ADDR A:0x601ff250
y.create.l HWIO_BOOT_ROM_XPU_PRT1_SCR_ADDR A:0x601ff2d0
y.create.l HWIO_BOOT_ROM_XPU_PRT2_SCR_ADDR A:0x601ff350
y.create.l HWIO_BOOT_ROM_XPU_PRT0_MCR_ADDR A:0x601ff254
y.create.l HWIO_BOOT_ROM_XPU_PRT1_MCR_ADDR A:0x601ff2d4
y.create.l HWIO_BOOT_ROM_XPU_PRT2_MCR_ADDR A:0x601ff354
y.create.l HWIO_BOOT_ROM_XPU_PRT0_CNTL0_ADDR A:0x601ff258
y.create.l HWIO_BOOT_ROM_XPU_PRT1_CNTL0_ADDR A:0x601ff2d8
y.create.l HWIO_BOOT_ROM_XPU_PRT2_CNTL0_ADDR A:0x601ff358
y.create.l HWIO_BOOT_ROM_XPU_PRT0_CNTL1_ADDR A:0x601ff25c
y.create.l HWIO_BOOT_ROM_XPU_PRT1_CNTL1_ADDR A:0x601ff2dc
y.create.l HWIO_BOOT_ROM_XPU_PRT2_CNTL1_ADDR A:0x601ff35c
y.create.l HWIO_GCC_GPLL0_MODE_ADDR A:0x61821000
y.create.l HWIO_GCC_GPLL0_L_VAL_ADDR A:0x61821004
y.create.l HWIO_GCC_GPLL0_ALPHA_VAL_ADDR A:0x61821008
y.create.l HWIO_GCC_GPLL0_ALPHA_VAL_U_ADDR A:0x6182100c
y.create.l HWIO_GCC_GPLL0_USER_CTL_ADDR A:0x61821010
y.create.l HWIO_GCC_GPLL0_USER_CTL_U_ADDR A:0x61821014
y.create.l HWIO_GCC_GPLL0_CONFIG_CTL_ADDR A:0x61821018
y.create.l HWIO_GCC_GPLL0_TEST_CTL_ADDR A:0x6182101c
y.create.l HWIO_GCC_GPLL0_TEST_CTL_U_ADDR A:0x61821020
y.create.l HWIO_GCC_GPLL0_FREQ_CTL_ADDR A:0x61821028
y.create.l HWIO_GCC_GPLL0_STATUS_ADDR A:0x61821024
y.create.l HWIO_GCC_GPLL1_MODE_ADDR A:0x61820000
y.create.l HWIO_GCC_GPLL1_L_VAL_ADDR A:0x61820004
y.create.l HWIO_GCC_GPLL1_ALPHA_VAL_ADDR A:0x61820008
y.create.l HWIO_GCC_GPLL1_ALPHA_VAL_U_ADDR A:0x6182000c
y.create.l HWIO_GCC_GPLL1_USER_CTL_ADDR A:0x61820010
y.create.l HWIO_GCC_GPLL1_CONFIG_CTL_ADDR A:0x61820018
y.create.l HWIO_GCC_GPLL1_TEST_CTL_ADDR A:0x6182001c
y.create.l HWIO_GCC_GPLL1_STATUS_ADDR A:0x61820024
y.create.l HWIO_GCC_GPLL3_MODE_ADDR A:0x61823000
y.create.l HWIO_GCC_GPLL3_L_VAL_ADDR A:0x61823004
y.create.l HWIO_GCC_GPLL3_ALPHA_VAL_ADDR A:0x61823008
y.create.l HWIO_GCC_GPLL3_ALPHA_VAL_U_ADDR A:0x6182300c
y.create.l HWIO_GCC_GPLL3_USER_CTL_ADDR A:0x61823010
y.create.l HWIO_GCC_GPLL3_USER_CTL_U_ADDR A:0x61823014
y.create.l HWIO_GCC_GPLL3_CONFIG_CTL_ADDR A:0x61823018
y.create.l HWIO_GCC_GPLL3_TEST_CTL_ADDR A:0x6182301c
y.create.l HWIO_GCC_GPLL3_TEST_CTL_U_ADDR A:0x61823020
y.create.l HWIO_GCC_GPLL3_FREQ_CTL_ADDR A:0x61823028
y.create.l HWIO_GCC_GPLL3_STATUS_ADDR A:0x61823024
y.create.l HWIO_GCC_GPLL2_MODE_ADDR A:0x61825000
y.create.l HWIO_GCC_GPLL2_L_VAL_ADDR A:0x61825004
y.create.l HWIO_GCC_GPLL2_ALPHA_VAL_ADDR A:0x61825008
y.create.l HWIO_GCC_GPLL2_ALPHA_VAL_U_ADDR A:0x6182500c
y.create.l HWIO_GCC_GPLL2_USER_CTL_ADDR A:0x61825010
y.create.l HWIO_GCC_GPLL2_USER_CTL_U_ADDR A:0x61825014
y.create.l HWIO_GCC_GPLL2_CONFIG_CTL_ADDR A:0x61825018
y.create.l HWIO_GCC_GPLL2_TEST_CTL_ADDR A:0x6182501c
y.create.l HWIO_GCC_GPLL2_TEST_CTL_U_ADDR A:0x61825020
y.create.l HWIO_GCC_GPLL2_FREQ_CTL_ADDR A:0x61825028
y.create.l HWIO_GCC_GPLL2_STATUS_ADDR A:0x61825024
y.create.l HWIO_GCC_SYSTEM_NOC_BCR_ADDR A:0x61826000
y.create.l HWIO_GCC_SYSTEM_NOC_BFDCD_CMD_RCGR_ADDR A:0x61826004
y.create.l HWIO_GCC_SYSTEM_NOC_BFDCD_CFG_RCGR_ADDR A:0x61826008
y.create.l HWIO_GCC_SNOC_QOSGEN_EXTREF_CTL_ADDR A:0x6182601c
y.create.l HWIO_GCC_PCNOC_BFDCD_CMD_RCGR_ADDR A:0x61827000
y.create.l HWIO_GCC_PCNOC_BFDCD_CFG_RCGR_ADDR A:0x61827004
y.create.l HWIO_GCC_SYS_NOC_AXI_CBCR_ADDR A:0x61826020
y.create.l HWIO_GCC_SYS_NOC_QDSS_STM_AXI_CBCR_ADDR A:0x61826024
y.create.l HWIO_GCC_SYS_NOC_APSS_AHB_CBCR_ADDR A:0x61826028
y.create.l HWIO_GCC_SNOC_PCNOC_AHB_CBCR_ADDR A:0x6182602c
y.create.l HWIO_GCC_SYS_NOC_AT_CBCR_ADDR A:0x61826030
y.create.l HWIO_GCC_PCNOC_BCR_ADDR A:0x61827018
y.create.l HWIO_GCC_PCNOC_AHB_CBCR_ADDR A:0x6182701c
y.create.l HWIO_GCC_PCNOC_DDR_CFG_CBCR_ADDR A:0x61827020
y.create.l HWIO_GCC_PCNOC_RPM_AHB_CBCR_ADDR A:0x61827024
y.create.l HWIO_GCC_PCNOC_AT_CBCR_ADDR A:0x61827028
y.create.l HWIO_GCC_NOC_CONF_XPU_AHB_CBCR_ADDR A:0x61817000
y.create.l HWIO_GCC_IMEM_BCR_ADDR A:0x6180e000
y.create.l HWIO_GCC_IMEM_AXI_CBCR_ADDR A:0x6180e004
y.create.l HWIO_GCC_IMEM_CFG_AHB_CBCR_ADDR A:0x6180e008
y.create.l HWIO_GCC_MSS_CFG_AHB_CBCR_ADDR A:0x61849000
y.create.l HWIO_GCC_MSS_Q6_BIMC_AXI_CBCR_ADDR A:0x61849004
y.create.l HWIO_GCC_RPM_CFG_XPU_CBCR_ADDR A:0x61817004
y.create.l HWIO_GCC_QDSS_BCR_ADDR A:0x61829000
y.create.l HWIO_GCC_QDSS_DAP_AHB_CBCR_ADDR A:0x61829004
y.create.l HWIO_GCC_QDSS_CFG_AHB_CBCR_ADDR A:0x61829008
y.create.l HWIO_GCC_QDSS_AT_CMD_RCGR_ADDR A:0x6182900c
y.create.l HWIO_GCC_QDSS_AT_CFG_RCGR_ADDR A:0x61829010
y.create.l HWIO_GCC_QDSS_AT_CBCR_ADDR A:0x61829024
y.create.l HWIO_GCC_QDSS_ETR_USB_CBCR_ADDR A:0x61829028
y.create.l HWIO_GCC_QDSS_STM_CMD_RCGR_ADDR A:0x6182902c
y.create.l HWIO_GCC_QDSS_STM_CFG_RCGR_ADDR A:0x61829030
y.create.l HWIO_GCC_QDSS_STM_CBCR_ADDR A:0x61829044
y.create.l HWIO_GCC_QDSS_TRACECLKIN_CMD_RCGR_ADDR A:0x61829048
y.create.l HWIO_GCC_QDSS_TRACECLKIN_CFG_RCGR_ADDR A:0x6182904c
y.create.l HWIO_GCC_QDSS_TRACECLKIN_CBCR_ADDR A:0x61829060
y.create.l HWIO_GCC_QDSS_TSCTR_CMD_RCGR_ADDR A:0x61829064
y.create.l HWIO_GCC_QDSS_TSCTR_CFG_RCGR_ADDR A:0x61829068
y.create.l HWIO_GCC_QDSS_TSCTR_DIV2_CBCR_ADDR A:0x6182907c
y.create.l HWIO_GCC_QDSS_TSCTR_DIV3_CBCR_ADDR A:0x61829080
y.create.l HWIO_GCC_QDSS_DAP_CBCR_ADDR A:0x61829084
y.create.l HWIO_GCC_QDSS_TSCTR_DIV4_CBCR_ADDR A:0x61829088
y.create.l HWIO_GCC_QDSS_TSCTR_DIV8_CBCR_ADDR A:0x6182908c
y.create.l HWIO_GCC_QDSS_TSCTR_DIV16_CBCR_ADDR A:0x61829090
y.create.l HWIO_GCC_GCC_SLEEP_CMD_RCGR_ADDR A:0x61830000
y.create.l HWIO_GCC_QUSB2A_PHY_BCR_ADDR A:0x61841028
y.create.l HWIO_GCC_SDCC1_BCR_ADDR A:0x61842000
y.create.l HWIO_GCC_SDCC1_APPS_CMD_RCGR_ADDR A:0x61842004
y.create.l HWIO_GCC_SDCC1_APPS_CFG_RCGR_ADDR A:0x61842008
y.create.l HWIO_GCC_SDCC1_APPS_M_ADDR A:0x6184200c
y.create.l HWIO_GCC_SDCC1_APPS_N_ADDR A:0x61842010
y.create.l HWIO_GCC_SDCC1_APPS_D_ADDR A:0x61842014
y.create.l HWIO_GCC_SDCC1_APPS_CBCR_ADDR A:0x61842018
y.create.l HWIO_GCC_SDCC1_AHB_CBCR_ADDR A:0x6184201c
y.create.l HWIO_GCC_BLSP1_BCR_ADDR A:0x61801000
y.create.l HWIO_GCC_BLSP1_SLEEP_CBCR_ADDR A:0x61801004
y.create.l HWIO_GCC_BLSP1_AHB_CBCR_ADDR A:0x61801008
y.create.l HWIO_GCC_BLSP1_QUP1_BCR_ADDR A:0x61802000
y.create.l HWIO_GCC_BLSP1_QUP1_SPI_APPS_CBCR_ADDR A:0x61802004
y.create.l HWIO_GCC_BLSP1_QUP1_I2C_APPS_CBCR_ADDR A:0x61802008
y.create.l HWIO_GCC_BLSP1_QUP1_I2C_APPS_CMD_RCGR_ADDR A:0x6180200c
y.create.l HWIO_GCC_BLSP1_QUP1_I2C_APPS_CFG_RCGR_ADDR A:0x61802010
y.create.l HWIO_GCC_BLSP1_QUP2_I2C_APPS_CMD_RCGR_ADDR A:0x61803000
y.create.l HWIO_GCC_BLSP1_QUP2_I2C_APPS_CFG_RCGR_ADDR A:0x61803004
y.create.l HWIO_GCC_BLSP1_QUP3_I2C_APPS_CMD_RCGR_ADDR A:0x61804000
y.create.l HWIO_GCC_BLSP1_QUP3_I2C_APPS_CFG_RCGR_ADDR A:0x61804004
y.create.l HWIO_GCC_BLSP1_QUP4_I2C_APPS_CMD_RCGR_ADDR A:0x61805000
y.create.l HWIO_GCC_BLSP1_QUP4_I2C_APPS_CFG_RCGR_ADDR A:0x61805004
y.create.l HWIO_GCC_BLSP1_QUP1_SPI_APPS_CMD_RCGR_ADDR A:0x61802024
y.create.l HWIO_GCC_BLSP1_QUP1_SPI_APPS_CFG_RCGR_ADDR A:0x61802028
y.create.l HWIO_GCC_BLSP1_QUP1_SPI_APPS_M_ADDR A:0x6180202c
y.create.l HWIO_GCC_BLSP1_QUP1_SPI_APPS_N_ADDR A:0x61802030
y.create.l HWIO_GCC_BLSP1_QUP1_SPI_APPS_D_ADDR A:0x61802034
y.create.l HWIO_GCC_BLSP1_UART1_BCR_ADDR A:0x61802038
y.create.l HWIO_GCC_BLSP1_UART1_APPS_CBCR_ADDR A:0x6180203c
y.create.l HWIO_GCC_BLSP1_UART1_SIM_CBCR_ADDR A:0x61802040
y.create.l HWIO_GCC_BLSP1_UART1_APPS_CMD_RCGR_ADDR A:0x61802044
y.create.l HWIO_GCC_BLSP1_UART1_APPS_CFG_RCGR_ADDR A:0x61802048
y.create.l HWIO_GCC_BLSP1_UART1_APPS_M_ADDR A:0x6180204c
y.create.l HWIO_GCC_BLSP1_UART1_APPS_N_ADDR A:0x61802050
y.create.l HWIO_GCC_BLSP1_UART1_APPS_D_ADDR A:0x61802054
y.create.l HWIO_GCC_BLSP1_QUP2_BCR_ADDR A:0x61803008
y.create.l HWIO_GCC_BLSP1_QUP2_SPI_APPS_CBCR_ADDR A:0x6180300c
y.create.l HWIO_GCC_BLSP1_QUP2_I2C_APPS_CBCR_ADDR A:0x61803010
y.create.l HWIO_GCC_BLSP1_QUP2_SPI_APPS_CMD_RCGR_ADDR A:0x61803014
y.create.l HWIO_GCC_BLSP1_QUP2_SPI_APPS_CFG_RCGR_ADDR A:0x61803018
y.create.l HWIO_GCC_BLSP1_QUP2_SPI_APPS_M_ADDR A:0x6180301c
y.create.l HWIO_GCC_BLSP1_QUP2_SPI_APPS_N_ADDR A:0x61803020
y.create.l HWIO_GCC_BLSP1_QUP2_SPI_APPS_D_ADDR A:0x61803024
y.create.l HWIO_GCC_BLSP1_UART2_BCR_ADDR A:0x61803028
y.create.l HWIO_GCC_BLSP1_UART2_APPS_CBCR_ADDR A:0x6180302c
y.create.l HWIO_GCC_BLSP1_UART2_SIM_CBCR_ADDR A:0x61803030
y.create.l HWIO_GCC_BLSP1_UART2_APPS_CMD_RCGR_ADDR A:0x61803034
y.create.l HWIO_GCC_BLSP1_UART2_APPS_CFG_RCGR_ADDR A:0x61803038
y.create.l HWIO_GCC_BLSP1_UART2_APPS_M_ADDR A:0x6180303c
y.create.l HWIO_GCC_BLSP1_UART2_APPS_N_ADDR A:0x61803040
y.create.l HWIO_GCC_BLSP1_UART2_APPS_D_ADDR A:0x61803044
y.create.l HWIO_GCC_BLSP1_QUP3_BCR_ADDR A:0x61804018
y.create.l HWIO_GCC_BLSP1_QUP3_SPI_APPS_CBCR_ADDR A:0x6180401c
y.create.l HWIO_GCC_BLSP1_QUP3_I2C_APPS_CBCR_ADDR A:0x61804020
y.create.l HWIO_GCC_BLSP1_QUP3_SPI_APPS_CMD_RCGR_ADDR A:0x61804024
y.create.l HWIO_GCC_BLSP1_QUP3_SPI_APPS_CFG_RCGR_ADDR A:0x61804028
y.create.l HWIO_GCC_BLSP1_QUP3_SPI_APPS_M_ADDR A:0x6180402c
y.create.l HWIO_GCC_BLSP1_QUP3_SPI_APPS_N_ADDR A:0x61804030
y.create.l HWIO_GCC_BLSP1_QUP3_SPI_APPS_D_ADDR A:0x61804034
y.create.l HWIO_GCC_BLSP1_UART3_BCR_ADDR A:0x61804038
y.create.l HWIO_GCC_BLSP1_UART3_APPS_CBCR_ADDR A:0x6180403c
y.create.l HWIO_GCC_BLSP1_UART3_SIM_CBCR_ADDR A:0x61804040
y.create.l HWIO_GCC_BLSP1_UART3_APPS_CMD_RCGR_ADDR A:0x61804044
y.create.l HWIO_GCC_BLSP1_UART3_APPS_CFG_RCGR_ADDR A:0x61804048
y.create.l HWIO_GCC_BLSP1_UART3_APPS_M_ADDR A:0x6180404c
y.create.l HWIO_GCC_BLSP1_UART3_APPS_N_ADDR A:0x61804050
y.create.l HWIO_GCC_BLSP1_UART3_APPS_D_ADDR A:0x61804054
y.create.l HWIO_GCC_BLSP1_QUP4_BCR_ADDR A:0x61805018
y.create.l HWIO_GCC_BLSP1_QUP4_SPI_APPS_CBCR_ADDR A:0x6180501c
y.create.l HWIO_GCC_BLSP1_QUP4_I2C_APPS_CBCR_ADDR A:0x61805020
y.create.l HWIO_GCC_BLSP1_QUP4_SPI_APPS_CMD_RCGR_ADDR A:0x61805024
y.create.l HWIO_GCC_BLSP1_QUP4_SPI_APPS_CFG_RCGR_ADDR A:0x61805028
y.create.l HWIO_GCC_BLSP1_QUP4_SPI_APPS_M_ADDR A:0x6180502c
y.create.l HWIO_GCC_BLSP1_QUP4_SPI_APPS_N_ADDR A:0x61805030
y.create.l HWIO_GCC_BLSP1_QUP4_SPI_APPS_D_ADDR A:0x61805034
y.create.l HWIO_GCC_BLSP1_UART4_BCR_ADDR A:0x61805038
y.create.l HWIO_GCC_BLSP1_UART4_APPS_CBCR_ADDR A:0x6180503c
y.create.l HWIO_GCC_BLSP1_UART4_SIM_CBCR_ADDR A:0x61805040
y.create.l HWIO_GCC_BLSP1_UART4_APPS_CMD_RCGR_ADDR A:0x61805044
y.create.l HWIO_GCC_BLSP1_UART4_APPS_CFG_RCGR_ADDR A:0x61805048
y.create.l HWIO_GCC_BLSP1_UART4_APPS_M_ADDR A:0x6180504c
y.create.l HWIO_GCC_BLSP1_UART4_APPS_N_ADDR A:0x61805050
y.create.l HWIO_GCC_BLSP1_UART4_APPS_D_ADDR A:0x61805054
y.create.l HWIO_GCC_BLSP_UART_SIM_CMD_RCGR_ADDR A:0x6180100c
y.create.l HWIO_GCC_BLSP_UART_SIM_CFG_RCGR_ADDR A:0x61801010
y.create.l HWIO_GCC_PRNG_XPU_CFG_AHB_CBCR_ADDR A:0x61817008
y.create.l HWIO_GCC_PDM_BCR_ADDR A:0x61844000
y.create.l HWIO_GCC_PDM_AHB_CBCR_ADDR A:0x61844004
y.create.l HWIO_GCC_PDM_XO4_CBCR_ADDR A:0x61844008
y.create.l HWIO_GCC_PDM2_CBCR_ADDR A:0x6184400c
y.create.l HWIO_GCC_PDM2_CMD_RCGR_ADDR A:0x61844010
y.create.l HWIO_GCC_PDM2_CFG_RCGR_ADDR A:0x61844014
y.create.l HWIO_GCC_PRNG_BCR_ADDR A:0x61813000
y.create.l HWIO_GCC_PRNG_AHB_CBCR_ADDR A:0x61813004
y.create.l HWIO_GCC_TCSR_BCR_ADDR A:0x61828000
y.create.l HWIO_GCC_TCSR_AHB_CBCR_ADDR A:0x61828004
y.create.l HWIO_GCC_BOOT_ROM_BCR_ADDR A:0x61813008
y.create.l HWIO_GCC_BOOT_ROM_AHB_CBCR_ADDR A:0x6181300c
y.create.l HWIO_GCC_MSG_RAM_BCR_ADDR A:0x6182b000
y.create.l HWIO_GCC_MSG_RAM_AHB_CBCR_ADDR A:0x6182b004
y.create.l HWIO_GCC_TLMM_BCR_ADDR A:0x61834000
y.create.l HWIO_GCC_TLMM_AHB_CBCR_ADDR A:0x61834004
y.create.l HWIO_GCC_TLMM_CBCR_ADDR A:0x61834008
y.create.l HWIO_GCC_MPM_BCR_ADDR A:0x6182c000
y.create.l HWIO_GCC_MPM_MISC_ADDR A:0x6182c004
y.create.l HWIO_GCC_MPM_AHB_CBCR_ADDR A:0x6182c008
y.create.l HWIO_GCC_RPM_PROC_HCLK_CBCR_ADDR A:0x6182d000
y.create.l HWIO_GCC_RPM_BUS_AHB_CBCR_ADDR A:0x6182d004
y.create.l HWIO_GCC_RPM_SLEEP_CBCR_ADDR A:0x6182d008
y.create.l HWIO_GCC_RPM_TIMER_CBCR_ADDR A:0x6182d00c
y.create.l HWIO_GCC_RPM_CMD_RCGR_ADDR A:0x6182d010
y.create.l HWIO_GCC_RPM_CFG_RCGR_ADDR A:0x6182d014
y.create.l HWIO_GCC_RPM_MISC_ADDR A:0x6182d028
y.create.l HWIO_GCC_SEC_CTRL_BCR_ADDR A:0x6181a000
y.create.l HWIO_GCC_ACC_CMD_RCGR_ADDR A:0x6181a004
y.create.l HWIO_GCC_ACC_CFG_RCGR_ADDR A:0x6181a008
y.create.l HWIO_GCC_ACC_MISC_ADDR A:0x6181a01c
y.create.l HWIO_GCC_SEC_CTRL_ACC_CBCR_ADDR A:0x6181a020
y.create.l HWIO_GCC_SEC_CTRL_AHB_CBCR_ADDR A:0x6181a024
y.create.l HWIO_GCC_SEC_CTRL_CBCR_ADDR A:0x6181a028
y.create.l HWIO_GCC_SEC_CTRL_SENSE_CBCR_ADDR A:0x6181a02c
y.create.l HWIO_GCC_SEC_CTRL_BOOT_ROM_PATCH_CBCR_ADDR A:0x6181a030
y.create.l HWIO_GCC_SEC_CTRL_CMD_RCGR_ADDR A:0x6181a034
y.create.l HWIO_GCC_SEC_CTRL_CFG_RCGR_ADDR A:0x6181a038
y.create.l HWIO_GCC_SPMI_BCR_ADDR A:0x6182e000
y.create.l HWIO_GCC_SPMI_SER_CMD_RCGR_ADDR A:0x6182e004
y.create.l HWIO_GCC_SPMI_SER_CFG_RCGR_ADDR A:0x6182e008
y.create.l HWIO_GCC_SPMI_SER_CBCR_ADDR A:0x6182e01c
y.create.l HWIO_GCC_SPMI_PCNOC_AHB_CBCR_ADDR A:0x6182e020
y.create.l HWIO_GCC_SPMI_AHB_CMD_RCGR_ADDR A:0x6182e024
y.create.l HWIO_GCC_SPMI_AHB_CFG_RCGR_ADDR A:0x6182e028
y.create.l HWIO_GCC_SPMI_AHB_CBCR_ADDR A:0x6182e03c
y.create.l HWIO_GCC_SPDM_BCR_ADDR A:0x6182f000
y.create.l HWIO_GCC_SPDM_CFG_AHB_CBCR_ADDR A:0x6182f004
y.create.l HWIO_GCC_SPDM_MSTR_AHB_CBCR_ADDR A:0x6182f008
y.create.l HWIO_GCC_SPDM_FF_CBCR_ADDR A:0x6182f00c
y.create.l HWIO_GCC_SPDM_BIMC_CY_CBCR_ADDR A:0x6182f010
y.create.l HWIO_GCC_SPDM_SNOC_CY_CBCR_ADDR A:0x6182f014
y.create.l HWIO_GCC_SPDM_DEBUG_CY_CBCR_ADDR A:0x6182f018
y.create.l HWIO_GCC_SPDM_PCNOC_CY_CBCR_ADDR A:0x6182f01c
y.create.l HWIO_GCC_SPDM_RPM_CY_CBCR_ADDR A:0x6182f020
y.create.l HWIO_GCC_CRYPTO_BCR_ADDR A:0x61816000
y.create.l HWIO_GCC_CRYPTO_CMD_RCGR_ADDR A:0x61816004
y.create.l HWIO_GCC_CRYPTO_CFG_RCGR_ADDR A:0x61816008
y.create.l HWIO_GCC_CRYPTO_CBCR_ADDR A:0x6181601c
y.create.l HWIO_GCC_CRYPTO_AXI_CBCR_ADDR A:0x61816020
y.create.l HWIO_GCC_CRYPTO_AHB_CBCR_ADDR A:0x61816024
y.create.l HWIO_GCC_GCC_AHB_CBCR_ADDR A:0x61830014
y.create.l HWIO_GCC_GCC_XO_CMD_RCGR_ADDR A:0x61830018
y.create.l HWIO_GCC_GCC_XO_CBCR_ADDR A:0x61830030
y.create.l HWIO_GCC_GCC_XO_DIV4_CBCR_ADDR A:0x61830034
y.create.l HWIO_GCC_GCC_IM_SLEEP_CBCR_ADDR A:0x61830038
y.create.l HWIO_GCC_BIMC_BCR_ADDR A:0x61831000
y.create.l HWIO_GCC_BIMC_GDSCR_ADDR A:0x61831004
y.create.l HWIO_GCC_BIMC_DDR_XO_CMD_RCGR_ADDR A:0x61832000
y.create.l HWIO_GCC_BIMC_XO_CBCR_ADDR A:0x61831008
y.create.l HWIO_GCC_BIMC_CFG_AHB_CBCR_ADDR A:0x6183100c
y.create.l HWIO_GCC_BIMC_SLEEP_CBCR_ADDR A:0x61831010
y.create.l HWIO_GCC_BIMC_SYSNOC_AXI_CBCR_ADDR A:0x61831014
y.create.l HWIO_GCC_BIMC_DDR_CMD_RCGR_ADDR A:0x61832004
y.create.l HWIO_GCC_BIMC_DDR_CFG_RCGR_ADDR A:0x61832008
y.create.l HWIO_GCC_BIMC_MISC_ADDR A:0x61831018
y.create.l HWIO_GCC_BIMC_CBCR_ADDR A:0x6183101c
y.create.l HWIO_GCC_BIMC_APSS_AXI_CBCR_ADDR A:0x61831020
y.create.l HWIO_GCC_DDR_DIM_CFG_CBCR_ADDR A:0x6183201c
y.create.l HWIO_GCC_DDR_DIM_SLEEP_CBCR_ADDR A:0x61832020
y.create.l HWIO_GCC_BIMC_TCU_CBCR_ADDR A:0x61831044
y.create.l HWIO_GCC_ULTAUDIO_PCNOC_MPORT_CBCR_ADDR A:0x6181c000
y.create.l HWIO_GCC_ULTAUDIO_PCNOC_SWAY_CBCR_ADDR A:0x6181c004
y.create.l HWIO_GCC_ULT_AUDIO_BCR_ADDR A:0x6181c0b4
y.create.l HWIO_GCC_APSS_AHB_CMD_RCGR_ADDR A:0x61846000
y.create.l HWIO_GCC_APSS_AHB_CFG_RCGR_ADDR A:0x61846004
y.create.l HWIO_GCC_APSS_AHB_MISC_ADDR A:0x61846018
y.create.l HWIO_GCC_APSS_AHB_CBCR_ADDR A:0x6184601c
y.create.l HWIO_GCC_APSS_AXI_CBCR_ADDR A:0x61846020
y.create.l HWIO_GCC_SNOC_BUS_TIMEOUT0_BCR_ADDR A:0x61847000
y.create.l HWIO_GCC_SNOC_BUS_TIMEOUT0_AHB_CBCR_ADDR A:0x61847004
y.create.l HWIO_GCC_PCNOC_BUS_TIMEOUT0_BCR_ADDR A:0x61848000
y.create.l HWIO_GCC_PCNOC_BUS_TIMEOUT0_AHB_CBCR_ADDR A:0x61848004
y.create.l HWIO_GCC_PCNOC_BUS_TIMEOUT1_BCR_ADDR A:0x61848008
y.create.l HWIO_GCC_PCNOC_BUS_TIMEOUT1_AHB_CBCR_ADDR A:0x6184800c
y.create.l HWIO_GCC_PCNOC_BUS_TIMEOUT2_BCR_ADDR A:0x61848010
y.create.l HWIO_GCC_PCNOC_BUS_TIMEOUT2_AHB_CBCR_ADDR A:0x61848014
y.create.l HWIO_GCC_PCNOC_BUS_TIMEOUT3_BCR_ADDR A:0x61848018
y.create.l HWIO_GCC_PCNOC_BUS_TIMEOUT3_AHB_CBCR_ADDR A:0x6184801c
y.create.l HWIO_GCC_PCNOC_BUS_TIMEOUT4_BCR_ADDR A:0x61848020
y.create.l HWIO_GCC_PCNOC_BUS_TIMEOUT4_AHB_CBCR_ADDR A:0x61848024
y.create.l HWIO_GCC_PCNOC_BUS_TIMEOUT5_BCR_ADDR A:0x61848028
y.create.l HWIO_GCC_PCNOC_BUS_TIMEOUT5_AHB_CBCR_ADDR A:0x6184802c
y.create.l HWIO_GCC_PCNOC_BUS_TIMEOUT6_BCR_ADDR A:0x61848030
y.create.l HWIO_GCC_PCNOC_BUS_TIMEOUT6_AHB_CBCR_ADDR A:0x61848034
y.create.l HWIO_GCC_PCNOC_BUS_TIMEOUT7_BCR_ADDR A:0x61848038
y.create.l HWIO_GCC_PCNOC_BUS_TIMEOUT7_AHB_CBCR_ADDR A:0x6184803c
y.create.l HWIO_GCC_PCNOC_BUS_TIMEOUT8_BCR_ADDR A:0x61848040
y.create.l HWIO_GCC_PCNOC_BUS_TIMEOUT8_AHB_CBCR_ADDR A:0x61848044
y.create.l HWIO_GCC_PCNOC_BUS_TIMEOUT9_BCR_ADDR A:0x61848048
y.create.l HWIO_GCC_PCNOC_BUS_TIMEOUT9_AHB_CBCR_ADDR A:0x6184804c
y.create.l HWIO_GCC_DEHR_BCR_ADDR A:0x6181f000
y.create.l HWIO_GCC_DEHR_CBCR_ADDR A:0x6181f004
y.create.l HWIO_GCC_PCNOC_MPU_CFG_AHB_CBCR_ADDR A:0x6181700c
y.create.l HWIO_GCC_APSS_TCU_CBCR_ADDR A:0x61812018
y.create.l HWIO_GCC_MSS_TBU_AXI_CBCR_ADDR A:0x61812024
y.create.l HWIO_GCC_MSS_TBU_Q6_AXI_CBCR_ADDR A:0x6181202c
y.create.l HWIO_GCC_PCNOC_TBU_CBCR_ADDR A:0x61812030
y.create.l HWIO_GCC_SMMU_CFG_CBCR_ADDR A:0x61812038
y.create.l HWIO_GCC_SMMU_XPU_CBCR_ADDR A:0x61817010
y.create.l HWIO_GCC_SMMU_CATS64_CBCR_ADDR A:0x6187c004
y.create.l HWIO_GCC_SMMU_CATS_BCR_ADDR A:0x6187c000
y.create.l HWIO_GCC_SMMU_BCR_ADDR A:0x61812000
y.create.l HWIO_GCC_APSS_TCU_BCR_ADDR A:0x61812050
y.create.l HWIO_GCC_MSS_TBU_AXI_BCR_ADDR A:0x61865000
y.create.l HWIO_GCC_MSS_TBU_Q6_AXI_BCR_ADDR A:0x61867000
y.create.l HWIO_GCC_SMMU_XPU_BCR_ADDR A:0x61812054
y.create.l HWIO_GCC_SMMU_CFG_BCR_ADDR A:0x61812094
y.create.l HWIO_GCC_PCNOC_TBU_BCR_ADDR A:0x61812058
y.create.l HWIO_GCC_RBCPR_BCR_ADDR A:0x61833000
y.create.l HWIO_GCC_RBCPR_CBCR_ADDR A:0x61833004
y.create.l HWIO_GCC_RBCPR_AHB_CBCR_ADDR A:0x61833008
y.create.l HWIO_GCC_RBCPR_CMD_RCGR_ADDR A:0x6183300c
y.create.l HWIO_GCC_RBCPR_CFG_RCGR_ADDR A:0x61833010
y.create.l HWIO_GCC_RPM_GPLL_ENA_VOTE_ADDR A:0x61836000
y.create.l HWIO_GCC_RPM_CLOCK_BRANCH_ENA_VOTE_ADDR A:0x61836004
y.create.l HWIO_GCC_RPM_SMMU_CLOCK_BRANCH_ENA_VOTE_ADDR A:0x6183600c
y.create.l HWIO_GCC_RPM_CLOCK_SLEEP_ENA_VOTE_ADDR A:0x61836008
y.create.l HWIO_GCC_RPM_SMMU_CLOCK_SLEEP_ENA_VOTE_ADDR A:0x61836010
y.create.l HWIO_GCC_APCS_GPLL_ENA_VOTE_ADDR A:0x61845000
y.create.l HWIO_GCC_APCS_CLOCK_BRANCH_ENA_VOTE_ADDR A:0x61845004
y.create.l HWIO_GCC_APCS_SMMU_CLOCK_BRANCH_ENA_VOTE_ADDR A:0x6184500c
y.create.l HWIO_GCC_APCS_CLOCK_SLEEP_ENA_VOTE_ADDR A:0x61845008
y.create.l HWIO_GCC_APCS_SMMU_CLOCK_SLEEP_ENA_VOTE_ADDR A:0x61845010
y.create.l HWIO_GCC_APCS_TZ_GPLL_ENA_VOTE_ADDR A:0x61813010
y.create.l HWIO_GCC_APCS_TZ_CLOCK_BRANCH_ENA_VOTE_ADDR A:0x61813014
y.create.l HWIO_GCC_APCS_TZ_SMMU_CLOCK_BRANCH_ENA_VOTE_ADDR A:0x61813020
y.create.l HWIO_GCC_APCS_TZ_CLOCK_SLEEP_ENA_VOTE_ADDR A:0x61813018
y.create.l HWIO_GCC_APCS_TZ_SMMU_CLOCK_SLEEP_ENA_VOTE_ADDR A:0x61813024
y.create.l HWIO_GCC_APCS_HYP_GPLL_ENA_VOTE_ADDR A:0x61861000
y.create.l HWIO_GCC_APCS_HYP_CLOCK_BRANCH_ENA_VOTE_ADDR A:0x61861004
y.create.l HWIO_GCC_APCS_HYP_SMMU_CLOCK_BRANCH_ENA_VOTE_ADDR A:0x6186100c
y.create.l HWIO_GCC_APCS_HYP_CLOCK_SLEEP_ENA_VOTE_ADDR A:0x61861008
y.create.l HWIO_GCC_APCS_HYP_SMMU_CLOCK_SLEEP_ENA_VOTE_ADDR A:0x61861010
y.create.l HWIO_GCC_MSS_Q6_GPLL_ENA_VOTE_ADDR A:0x6181b000
y.create.l HWIO_GCC_MSS_Q6_CLOCK_BRANCH_ENA_VOTE_ADDR A:0x6181b004
y.create.l HWIO_GCC_MSS_Q6_CLOCK_SLEEP_ENA_VOTE_ADDR A:0x6181b008
y.create.l HWIO_GCC_SPARE_GPLL_ENA_VOTE_ADDR A:0x61800000
y.create.l HWIO_GCC_SPARE_CLOCK_BRANCH_ENA_VOTE_ADDR A:0x61800004
y.create.l HWIO_GCC_MSS_RESTART_ADDR A:0x61810000
y.create.l HWIO_GCC_RESET_DEBUG_ADDR A:0x61814000
y.create.l HWIO_GCC_FLUSH_ETR_DEBUG_TIMER_ADDR A:0x61815000
y.create.l HWIO_GCC_STOP_CAPTURE_DEBUG_TIMER_ADDR A:0x61815004
y.create.l HWIO_GCC_RESET_STATUS_ADDR A:0x61815008
y.create.l HWIO_GCC_SW_SRST_ADDR A:0x6181500c
y.create.l HWIO_GCC_PROC_HALT_ADDR A:0x6181301c
y.create.l HWIO_GCC_GCC_DEBUG_CLK_CTL_ADDR A:0x61874000
y.create.l HWIO_GCC_CLOCK_FRQ_MEASURE_CTL_ADDR A:0x61874004
y.create.l HWIO_GCC_CLOCK_FRQ_MEASURE_STATUS_ADDR A:0x61874008
y.create.l HWIO_GCC_PLLTEST_PAD_CFG_ADDR A:0x6187400c
y.create.l HWIO_GCC_JITTER_PROBE_CFG_ADDR A:0x61874010
y.create.l HWIO_GCC_JITTER_PROBE_VAL_ADDR A:0x61874014
y.create.l HWIO_GCC_GP1_CBCR_ADDR A:0x61808000
y.create.l HWIO_GCC_GP1_CMD_RCGR_ADDR A:0x61808004
y.create.l HWIO_GCC_GP1_CFG_RCGR_ADDR A:0x61808008
y.create.l HWIO_GCC_GP1_M_ADDR A:0x6180800c
y.create.l HWIO_GCC_GP1_N_ADDR A:0x61808010
y.create.l HWIO_GCC_GP1_D_ADDR A:0x61808014
y.create.l HWIO_GCC_GP2_CBCR_ADDR A:0x61809000
y.create.l HWIO_GCC_GP2_CMD_RCGR_ADDR A:0x61809004
y.create.l HWIO_GCC_GP2_CFG_RCGR_ADDR A:0x61809008
y.create.l HWIO_GCC_GP2_M_ADDR A:0x6180900c
y.create.l HWIO_GCC_GP2_N_ADDR A:0x61809010
y.create.l HWIO_GCC_GP2_D_ADDR A:0x61809014
y.create.l HWIO_GCC_GP3_CBCR_ADDR A:0x6180a000
y.create.l HWIO_GCC_GP3_CMD_RCGR_ADDR A:0x6180a004
y.create.l HWIO_GCC_GP3_CFG_RCGR_ADDR A:0x6180a008
y.create.l HWIO_GCC_GP3_M_ADDR A:0x6180a00c
y.create.l HWIO_GCC_GP3_N_ADDR A:0x6180a010
y.create.l HWIO_GCC_GP3_D_ADDR A:0x6180a014
y.create.l HWIO_GCC_APSS_MISC_ADDR A:0x61860000
y.create.l HWIO_GCC_TIC_MODE_APSS_BOOT_ADDR A:0x6187f000
y.create.l HWIO_GCC_USB_BOOT_CLOCK_CTL_ADDR A:0x61840000
y.create.l HWIO_GCC_RAW_SLEEP_CLK_CTRL_ADDR A:0x61835000
y.create.l HWIO_GCC_GCC_SPARE0_REG_ADDR A:0x61800008
y.create.l HWIO_GCC_GCC_SPARE1_REG_ADDR A:0x6180000c
y.create.l HWIO_GCC_GCC_SPARE2_REG_ADDR A:0x6187e000
y.create.l HWIO_GCC_GCC_SPARE3_REG_ADDR A:0x6187e004
y.create.l HWIO_GCC_DCD_BCR_ADDR A:0x6182a000
y.create.l HWIO_GCC_DCD_XO_CBCR_ADDR A:0x6182a004
y.create.l HWIO_GCC_SNOC_DCD_CONFIG_ADDR A:0x6182a008
y.create.l HWIO_GCC_SNOC_DCD_HYSTERESIS_CNT_ADDR A:0x6182a00c
y.create.l HWIO_GCC_PCNOC_DCD_CONFIG_ADDR A:0x6182a010
y.create.l HWIO_GCC_PCNOC_DCD_HYSTERESIS_CNT_ADDR A:0x6182a014
y.create.l HWIO_GCC_AUDIO_CORE_BCR_ADDR A:0x6181c008
y.create.l HWIO_GCC_ULTAUDIO_LPAIF_PRI_I2S_CMD_RCGR_ADDR A:0x6181c054
y.create.l HWIO_GCC_ULTAUDIO_LPAIF_PRI_I2S_CFG_RCGR_ADDR A:0x6181c058
y.create.l HWIO_GCC_ULTAUDIO_LPAIF_PRI_I2S_M_ADDR A:0x6181c05c
y.create.l HWIO_GCC_ULTAUDIO_LPAIF_PRI_I2S_N_ADDR A:0x6181c060
y.create.l HWIO_GCC_ULTAUDIO_LPAIF_PRI_I2S_D_ADDR A:0x6181c064
y.create.l HWIO_GCC_ULTAUDIO_LPAIF_PRI_I2S_CBCR_ADDR A:0x6181c068
y.create.l HWIO_GCC_ULTAUDIO_LPAIF_SEC_I2S_CMD_RCGR_ADDR A:0x6181c06c
y.create.l HWIO_GCC_ULTAUDIO_LPAIF_SEC_I2S_CFG_RCGR_ADDR A:0x6181c070
y.create.l HWIO_GCC_ULTAUDIO_LPAIF_SEC_I2S_M_ADDR A:0x6181c074
y.create.l HWIO_GCC_ULTAUDIO_LPAIF_SEC_I2S_N_ADDR A:0x6181c078
y.create.l HWIO_GCC_ULTAUDIO_LPAIF_SEC_I2S_D_ADDR A:0x6181c07c
y.create.l HWIO_GCC_ULTAUDIO_LPAIF_SEC_I2S_CBCR_ADDR A:0x6181c080
y.create.l HWIO_GCC_ULTAUDIO_XO_CMD_RCGR_ADDR A:0x6181c034
y.create.l HWIO_GCC_ULTAUDIO_XO_CFG_RCGR_ADDR A:0x6181c038
y.create.l HWIO_GCC_ULTAUDIO_AHBFABRIC_CMD_RCGR_ADDR A:0x6181c010
y.create.l HWIO_GCC_ULTAUDIO_AHBFABRIC_CFG_RCGR_ADDR A:0x6181c014
y.create.l HWIO_GCC_ULTAUDIO_AHBFABRIC_M_ADDR A:0x6181c018
y.create.l HWIO_GCC_ULTAUDIO_AHBFABRIC_N_ADDR A:0x6181c01c
y.create.l HWIO_GCC_ULTAUDIO_AHBFABRIC_D_ADDR A:0x6181c020
y.create.l HWIO_GCC_ULTAUDIO_AHBFABRIC_IXFABRIC_LPM_CBCR_ADDR A:0x6181c024
y.create.l HWIO_GCC_ULTAUDIO_AHBFABRIC_IXFABRIC_CBCR_ADDR A:0x6181c028
y.create.l HWIO_GCC_ULTAUDIO_AHBFABRIC_EFABRIC_SPDM_CBCR_ADDR A:0x6181c030
y.create.l HWIO_GCC_ULTAUDIO_LPAIF_AUX_I2S_CMD_RCGR_ADDR A:0x6181c084
y.create.l HWIO_GCC_ULTAUDIO_LPAIF_AUX_I2S_CFG_RCGR_ADDR A:0x6181c088
y.create.l HWIO_GCC_ULTAUDIO_LPAIF_AUX_I2S_M_ADDR A:0x6181c08c
y.create.l HWIO_GCC_ULTAUDIO_LPAIF_AUX_I2S_N_ADDR A:0x6181c090
y.create.l HWIO_GCC_ULTAUDIO_LPAIF_AUX_I2S_D_ADDR A:0x6181c094
y.create.l HWIO_GCC_ULTAUDIO_LPAIF_AUX_I2S_CBCR_ADDR A:0x6181c098
y.create.l HWIO_GCC_SYS_NOC_IPA_AXI_CBCR_ADDR A:0x6183e028
y.create.l HWIO_GCC_IPA_BCR_ADDR A:0x6183e000
y.create.l HWIO_GCC_IPA_CMD_RCGR_ADDR A:0x6183e004
y.create.l HWIO_GCC_IPA_CFG_RCGR_ADDR A:0x6183e008
y.create.l HWIO_GCC_IPA_M_ADDR A:0x6183e00c
y.create.l HWIO_GCC_IPA_N_ADDR A:0x6183e010
y.create.l HWIO_GCC_IPA_D_ADDR A:0x6183e014
y.create.l HWIO_GCC_IPA_CBCR_ADDR A:0x6183e018
y.create.l HWIO_GCC_IPA_AHB_CBCR_ADDR A:0x6183e01c
y.create.l HWIO_GCC_IPA_SLEEP_CBCR_ADDR A:0x6183e020
y.create.l HWIO_GCC_RBCPR_MX_BCR_ADDR A:0x6183d000
y.create.l HWIO_GCC_RBCPR_MX_CBCR_ADDR A:0x6183d004
y.create.l HWIO_GCC_RBCPR_MX_AHB_CBCR_ADDR A:0x6183d008
y.create.l HWIO_GCC_RBCPR_MX_CMD_RCGR_ADDR A:0x6183d00c
y.create.l HWIO_GCC_RBCPR_MX_CFG_RCGR_ADDR A:0x6183d010
y.create.l HWIO_GCC_QPIC_BCR_ADDR A:0x6183f000
y.create.l HWIO_GCC_QPIC_CMD_RCGR_ADDR A:0x6183f004
y.create.l HWIO_GCC_QPIC_CFG_RCGR_ADDR A:0x6183f008
y.create.l HWIO_GCC_QPIC_M_ADDR A:0x6183f00c
y.create.l HWIO_GCC_QPIC_N_ADDR A:0x6183f010
y.create.l HWIO_GCC_QPIC_D_ADDR A:0x6183f014
y.create.l HWIO_GCC_QPIC_CBCR_ADDR A:0x6183f018
y.create.l HWIO_GCC_QPIC_AHB_CBCR_ADDR A:0x6183f01c
y.create.l HWIO_GCC_QPIC_SYSTEM_CBCR_ADDR A:0x6183f020
y.create.l HWIO_GCC_SNOC_BUS_TIMEOUT2_BCR_ADDR A:0x61847008
y.create.l HWIO_GCC_SNOC_BUS_TIMEOUT2_AHB_CBCR_ADDR A:0x6184700c
y.create.l HWIO_GCC_PCIE_BOOT_CLOCK_CTL_ADDR A:0x6185d000
y.create.l HWIO_GCC_PCIE_BCR_ADDR A:0x6185d004
y.create.l HWIO_GCC_PCIE_CFG_AHB_CBCR_ADDR A:0x6185d008
y.create.l HWIO_GCC_PCIE_PIPE_CBCR_ADDR A:0x6185d00c
y.create.l HWIO_GCC_PCIE_AXI_CBCR_ADDR A:0x6185d010
y.create.l HWIO_GCC_PCIE_SLEEP_CBCR_ADDR A:0x6185d014
y.create.l HWIO_GCC_PCIE_AXI_MSTR_CBCR_ADDR A:0x6185d018
y.create.l HWIO_GCC_PCIE_PIPE_CMD_RCGR_ADDR A:0x6185d01c
y.create.l HWIO_GCC_PCIE_PIPE_CFG_RCGR_ADDR A:0x6185d020
y.create.l HWIO_GCC_PCIE_AUX_CMD_RCGR_ADDR A:0x6185d030
y.create.l HWIO_GCC_PCIE_AUX_CFG_RCGR_ADDR A:0x6185d034
y.create.l HWIO_GCC_PCIE_AUX_M_ADDR A:0x6185d038
y.create.l HWIO_GCC_PCIE_AUX_N_ADDR A:0x6185d03c
y.create.l HWIO_GCC_PCIE_AUX_D_ADDR A:0x6185d040
y.create.l HWIO_GCC_PCIE_GDSCR_ADDR A:0x6185d044
y.create.l HWIO_GCC_PCIEPHY_PHY_BCR_ADDR A:0x6185d048
y.create.l HWIO_GCC_PCIE_GPIO_LDO_EN_ADDR A:0x6185d04c
y.create.l HWIO_GCC_PCIE_PHY_BCR_ADDR A:0x6185d050
y.create.l HWIO_GCC_PCIE_MISC_RESET_ADDR A:0x6185d054
y.create.l HWIO_GCC_PCIE_LINK_DOWN_BCR_ADDR A:0x6185d05c
y.create.l HWIO_GCC_USB_SS_LDO_EN_ADDR A:0x6185e07c
y.create.l HWIO_GCC_USB_PHY_CFG_AHB_CBCR_ADDR A:0x6185e080
y.create.l HWIO_GCC_SYS_NOC_USB3_AXI_CBCR_ADDR A:0x6185e084
y.create.l HWIO_GCC_USB_30_BCR_ADDR A:0x6185e070
y.create.l HWIO_GCC_USB_30_MISC_ADDR A:0x6185e074
y.create.l HWIO_GCC_USB30_MASTER_CBCR_ADDR A:0x6185e000
y.create.l HWIO_GCC_USB30_SLEEP_CBCR_ADDR A:0x6185e004
y.create.l HWIO_GCC_USB30_MOCK_UTMI_CBCR_ADDR A:0x6185e008
y.create.l HWIO_GCC_USB30_MASTER_CMD_RCGR_ADDR A:0x6185e00c
y.create.l HWIO_GCC_USB30_MASTER_CFG_RCGR_ADDR A:0x6185e010
y.create.l HWIO_GCC_USB30_MASTER_M_ADDR A:0x6185e014
y.create.l HWIO_GCC_USB30_MASTER_N_ADDR A:0x6185e018
y.create.l HWIO_GCC_USB30_MASTER_D_ADDR A:0x6185e01c
y.create.l HWIO_GCC_USB30_MOCK_UTMI_CMD_RCGR_ADDR A:0x6185e020
y.create.l HWIO_GCC_USB30_MOCK_UTMI_CFG_RCGR_ADDR A:0x6185e024
y.create.l HWIO_GCC_USB3_PHY_BCR_ADDR A:0x6185e034
y.create.l HWIO_GCC_USB3PHY_PHY_BCR_ADDR A:0x6185e03c
y.create.l HWIO_GCC_USB3_PIPE_CBCR_ADDR A:0x6185e040
y.create.l HWIO_GCC_USB3_AUX_CBCR_ADDR A:0x6185e044
y.create.l HWIO_GCC_USB3_PIPE_CMD_RCGR_ADDR A:0x6185e048
y.create.l HWIO_GCC_USB3_PIPE_CFG_RCGR_ADDR A:0x6185e04c
y.create.l HWIO_GCC_USB3_AUX_CMD_RCGR_ADDR A:0x6185e05c
y.create.l HWIO_GCC_USB3_AUX_CFG_RCGR_ADDR A:0x6185e060
y.create.l HWIO_GCC_USB3_AUX_M_ADDR A:0x6185e064
y.create.l HWIO_GCC_USB3_AUX_N_ADDR A:0x6185e068
y.create.l HWIO_GCC_USB3_AUX_D_ADDR A:0x6185e06c
y.create.l HWIO_GCC_USB_30_GDSCR_ADDR A:0x6185e078
y.create.l HWIO_GCC_IPA_TBU_CBCR_ADDR A:0x6181205c
y.create.l HWIO_GCC_USB3_AXI_TBU_CBCR_ADDR A:0x61812060
y.create.l HWIO_GCC_PCIE_AXI_TBU_CBCR_ADDR A:0x61812064
y.create.l HWIO_GCC_MSS_TBU_MCDMA_AXI_CBCR_ADDR A:0x61812068
y.create.l HWIO_GCC_IPA_TBU_BCR_ADDR A:0x6186e000
y.create.l HWIO_GCC_USB3_AXI_TBU_BCR_ADDR A:0x6186f000
y.create.l HWIO_GCC_PCIE_AXI_TBU_BCR_ADDR A:0x6187d000
y.create.l HWIO_GCC_MSS_TBU_MCDMA_AXI_BCR_ADDR A:0x6187b000
y.create.l HWIO_GCC_MSS_MCDMA_BIMC_CMD_RCGR_ADDR A:0x6184900c
y.create.l HWIO_GCC_MSS_MCDMA_BIMC_CFG_RCGR_ADDR A:0x61849010
y.create.l HWIO_GCC_BIMC_MCDMA_AXI_CBCR_ADDR A:0x61849024
y.create.l HWIO_GCC_ULTAUDIO_LPAIF_EXT_I2S_CMD_RCGR_ADDR A:0x6181c0d8
y.create.l HWIO_GCC_ULTAUDIO_LPAIF_EXT_I2S_CFG_RCGR_ADDR A:0x6181c0dc
y.create.l HWIO_GCC_ULTAUDIO_LPAIF_EXT_I2S_M_ADDR A:0x6181c0e0
y.create.l HWIO_GCC_ULTAUDIO_LPAIF_EXT_I2S_N_ADDR A:0x6181c0e4
y.create.l HWIO_GCC_ULTAUDIO_LPAIF_EXT_I2S_D_ADDR A:0x6181c0e8
y.create.l HWIO_GCC_ULTAUDIO_LPAIF_EXT_I2S_CBCR_ADDR A:0x6181c0ec
y.create.l HWIO_GCC_ULTAUDIO_LPAIF_SLIMBUS_CORE_CMD_RCGR_ADDR A:0x6181c0c0
y.create.l HWIO_GCC_ULTAUDIO_LPAIF_SLIMBUS_CORE_CFG_RCGR_ADDR A:0x6181c0c4
y.create.l HWIO_GCC_ULTAUDIO_LPAIF_SLIMBUS_CORE_M_ADDR A:0x6181c0c8
y.create.l HWIO_GCC_ULTAUDIO_LPAIF_SLIMBUS_CORE_N_ADDR A:0x6181c0cc
y.create.l HWIO_GCC_ULTAUDIO_LPAIF_SLIMBUS_CORE_D_ADDR A:0x6181c0d0
y.create.l HWIO_GCC_ULTAUDIO_LPAIF_SLIMBUS_CORE_CBCR_ADDR A:0x6181c0d4
y.create.l HWIO_GCC_ULTAUDIO_LPAIF_SLIMBUS_BAM_CBCR_ADDR A:0x6181c0bc
y.create.l HWIO_GCC_AUDIO_EXT_REF_CLK_SEL_ADDR A:0x6181c0b8
y.create.l HWIO_GCC_SMMU_TCU_BIMC_CMD_RCGR_ADDR A:0x6181206c
y.create.l HWIO_GCC_SMMU_TCU_BIMC_CFG_RCGR_ADDR A:0x61812070
y.create.l HWIO_GCC_SMMU_CATS_2X_CMD_RCGR_ADDR A:0x6187c010
y.create.l HWIO_GCC_SMMU_CATS_2X_CFG_RCGR_ADDR A:0x6187c014
y.create.l HWIO_GCC_SYS_NOC_CATS_CBCR_ADDR A:0x6187c00c
y.create.l HWIO_GCC_DDR_VOLTAGE_DROOP_DETECTOR_GPLL0_CBCR_ADDR A:0x6187a004
y.create.l HWIO_GCC_VOLTAGE_DROOP_DETECTOR_BCR_ADDR A:0x6187a000
y.create.l HWIO_GCC_ULTAUDIO_LPAIF_PCM_DATAOE_CMD_RCGR_ADDR A:0x6181c0f0
y.create.l HWIO_GCC_ULTAUDIO_LPAIF_PCM_DATAOE_CFG_RCGR_ADDR A:0x6181c0f4
y.create.l HWIO_GCC_ULTAUDIO_LPAIF_PCM_DATAOE_M_ADDR A:0x6181c0f8
y.create.l HWIO_GCC_ULTAUDIO_LPAIF_PCM_DATAOE_N_ADDR A:0x6181c0fc
y.create.l HWIO_GCC_ULTAUDIO_LPAIF_PCM_DATAOE_D_ADDR A:0x6181c100
y.create.l HWIO_GCC_ULTAUDIO_LPAIF_PCM_DATAOE_CBCR_ADDR A:0x6181c104
y.create.l HWIO_GCC_ULTAUDIO_LPAIF_AUX_PCM_DATAOE_CMD_RCGR_ADDR A:0x6181c108
y.create.l HWIO_GCC_ULTAUDIO_LPAIF_AUX_PCM_DATAOE_CFG_RCGR_ADDR A:0x6181c10c
y.create.l HWIO_GCC_ULTAUDIO_LPAIF_AUX_PCM_DATAOE_M_ADDR A:0x6181c110
y.create.l HWIO_GCC_ULTAUDIO_LPAIF_AUX_PCM_DATAOE_N_ADDR A:0x6181c114
y.create.l HWIO_GCC_ULTAUDIO_LPAIF_AUX_PCM_DATAOE_D_ADDR A:0x6181c118
y.create.l HWIO_GCC_ULTAUDIO_LPAIF_AUX_PCM_DATAOE_CBCR_ADDR A:0x6181c11c
y.create.l HWIO_GCC_ULTAUDIO_AVSYNC_XO_CBCR_ADDR A:0x6181c04c
y.create.l HWIO_GCC_RPU_XPU_SCR_ADDR A:0x61880000
y.create.l HWIO_GCC_RPU_XPU_SWDR_ADDR A:0x61880004
y.create.l HWIO_GCC_RPU_XPU_SEAR0_ADDR A:0x61880040
y.create.l HWIO_GCC_RPU_XPU_SESR_ADDR A:0x61880048
y.create.l HWIO_GCC_RPU_XPU_SESRRESTORE_ADDR A:0x6188004c
y.create.l HWIO_GCC_RPU_XPU_SESYNR0_ADDR A:0x61880050
y.create.l HWIO_GCC_RPU_XPU_SESYNR1_ADDR A:0x61880054
y.create.l HWIO_GCC_RPU_XPU_SESYNR2_ADDR A:0x61880058
y.create.l HWIO_GCC_RPU_XPU_MCR_ADDR A:0x61880100
y.create.l HWIO_GCC_RPU_XPU_MEAR0_ADDR A:0x61880140
y.create.l HWIO_GCC_RPU_XPU_MESR_ADDR A:0x61880148
y.create.l HWIO_GCC_RPU_XPU_MESRRESTORE_ADDR A:0x6188014c
y.create.l HWIO_GCC_RPU_XPU_MESYNR0_ADDR A:0x61880150
y.create.l HWIO_GCC_RPU_XPU_MESYNR1_ADDR A:0x61880154
y.create.l HWIO_GCC_RPU_XPU_MESYNR2_ADDR A:0x61880158
y.create.l HWIO_GCC_RPU_XPU_CR_ADDR A:0x61880080
y.create.l HWIO_GCC_RPU_XPU_RPU_ACR0_ADDR A:0x618800a0
y.create.l HWIO_GCC_RPU_XPU_EAR0_ADDR A:0x618800c0
y.create.l HWIO_GCC_RPU_XPU_ESR_ADDR A:0x618800c8
y.create.l HWIO_GCC_RPU_XPU_ESRRESTORE_ADDR A:0x618800cc
y.create.l HWIO_GCC_RPU_XPU_ESYNR0_ADDR A:0x618800d0
y.create.l HWIO_GCC_RPU_XPU_ESYNR1_ADDR A:0x618800d4
y.create.l HWIO_GCC_RPU_XPU_ESYNR2_ADDR A:0x618800d8
y.create.l HWIO_GCC_RPU_XPU_IDR0_ADDR A:0x61880074
y.create.l HWIO_GCC_RPU_XPU_IDR1_ADDR A:0x61880078
y.create.l HWIO_GCC_RPU_XPU_REV_ADDR A:0x6188007c
y.create.l HWIO_GCC_RPU_XPU_RG0_RACR0_ADDR A:0x61880200
y.create.l HWIO_GCC_RPU_XPU_RG1_RACR0_ADDR A:0x61880280
y.create.l HWIO_GCC_RPU_XPU_RG2_RACR0_ADDR A:0x61880300
y.create.l HWIO_GCC_RPU_XPU_RG3_RACR0_ADDR A:0x61880380
y.create.l HWIO_GCC_RPU_XPU_RG4_RACR0_ADDR A:0x61880400
y.create.l HWIO_GCC_RPU_XPU_RG5_RACR0_ADDR A:0x61880480
y.create.l HWIO_GCC_RPU_XPU_RG6_RACR0_ADDR A:0x61880500
y.create.l HWIO_GCC_RPU_XPU_RG7_RACR0_ADDR A:0x61880580
y.create.l HWIO_GCC_RPU_XPU_RG8_RACR0_ADDR A:0x61880600
y.create.l HWIO_GCC_RPU_XPU_RG9_RACR0_ADDR A:0x61880680
y.create.l HWIO_GCC_RPU_XPU_RG0_WACR0_ADDR A:0x61880220
y.create.l HWIO_GCC_RPU_XPU_RG1_WACR0_ADDR A:0x618802a0
y.create.l HWIO_GCC_RPU_XPU_RG2_WACR0_ADDR A:0x61880320
y.create.l HWIO_GCC_RPU_XPU_RG3_WACR0_ADDR A:0x618803a0
y.create.l HWIO_GCC_RPU_XPU_RG4_WACR0_ADDR A:0x61880420
y.create.l HWIO_GCC_RPU_XPU_RG5_WACR0_ADDR A:0x618804a0
y.create.l HWIO_GCC_RPU_XPU_RG6_WACR0_ADDR A:0x61880520
y.create.l HWIO_GCC_RPU_XPU_RG7_WACR0_ADDR A:0x618805a0
y.create.l HWIO_GCC_RPU_XPU_RG8_WACR0_ADDR A:0x61880620
y.create.l HWIO_GCC_RPU_XPU_RG9_WACR0_ADDR A:0x618806a0
y.create.l HWIO_GCC_RPU_XPU_RG0_SCR_ADDR A:0x61880250
y.create.l HWIO_GCC_RPU_XPU_RG1_SCR_ADDR A:0x618802d0
y.create.l HWIO_GCC_RPU_XPU_RG2_SCR_ADDR A:0x61880350
y.create.l HWIO_GCC_RPU_XPU_RG3_SCR_ADDR A:0x618803d0
y.create.l HWIO_GCC_RPU_XPU_RG4_SCR_ADDR A:0x61880450
y.create.l HWIO_GCC_RPU_XPU_RG5_SCR_ADDR A:0x618804d0
y.create.l HWIO_GCC_RPU_XPU_RG6_SCR_ADDR A:0x61880550
y.create.l HWIO_GCC_RPU_XPU_RG7_SCR_ADDR A:0x618805d0
y.create.l HWIO_GCC_RPU_XPU_RG8_SCR_ADDR A:0x61880650
y.create.l HWIO_GCC_RPU_XPU_RG9_SCR_ADDR A:0x618806d0
y.create.l HWIO_GCC_RPU_XPU_RG0_MCR_ADDR A:0x61880254
y.create.l HWIO_GCC_RPU_XPU_RG1_MCR_ADDR A:0x618802d4
y.create.l HWIO_GCC_RPU_XPU_RG2_MCR_ADDR A:0x61880354
y.create.l HWIO_GCC_RPU_XPU_RG3_MCR_ADDR A:0x618803d4
y.create.l HWIO_GCC_RPU_XPU_RG4_MCR_ADDR A:0x61880454
y.create.l HWIO_GCC_RPU_XPU_RG5_MCR_ADDR A:0x618804d4
y.create.l HWIO_GCC_RPU_XPU_RG6_MCR_ADDR A:0x61880554
y.create.l HWIO_GCC_RPU_XPU_RG7_MCR_ADDR A:0x618805d4
y.create.l HWIO_GCC_RPU_XPU_RG8_MCR_ADDR A:0x61880654
y.create.l HWIO_GCC_RPU_XPU_RG9_MCR_ADDR A:0x618806d4
y.create.l HWIO_TCSR_MUTEX_REG_0_ADDR A:0x61905000
y.create.l HWIO_TCSR_MUTEX_REG_1_ADDR A:0x61906000
y.create.l HWIO_TCSR_MUTEX_REG_2_ADDR A:0x61907000
y.create.l HWIO_TCSR_MUTEX_REG_3_ADDR A:0x61908000
y.create.l HWIO_TCSR_MUTEX_REG_4_ADDR A:0x61909000
y.create.l HWIO_TCSR_MUTEX_REG_5_ADDR A:0x6190a000
y.create.l HWIO_TCSR_MUTEX_REG_6_ADDR A:0x6190b000
y.create.l HWIO_TCSR_MUTEX_REG_7_ADDR A:0x6190c000
y.create.l HWIO_TCSR_MUTEX_REG_8_ADDR A:0x6190d000
y.create.l HWIO_TCSR_MUTEX_REG_9_ADDR A:0x6190e000
y.create.l HWIO_TCSR_REGS_XPU_SCR_ADDR A:0x61936000
y.create.l HWIO_TCSR_REGS_XPU_SWDR_ADDR A:0x61936004
y.create.l HWIO_TCSR_REGS_XPU_SEAR0_ADDR A:0x61936040
y.create.l HWIO_TCSR_REGS_XPU_SESR_ADDR A:0x61936048
y.create.l HWIO_TCSR_REGS_XPU_SESRRESTORE_ADDR A:0x6193604c
y.create.l HWIO_TCSR_REGS_XPU_SESYNR0_ADDR A:0x61936050
y.create.l HWIO_TCSR_REGS_XPU_SESYNR1_ADDR A:0x61936054
y.create.l HWIO_TCSR_REGS_XPU_SESYNR2_ADDR A:0x61936058
y.create.l HWIO_TCSR_REGS_XPU_MCR_ADDR A:0x61936100
y.create.l HWIO_TCSR_REGS_XPU_MEAR0_ADDR A:0x61936140
y.create.l HWIO_TCSR_REGS_XPU_MESR_ADDR A:0x61936148
y.create.l HWIO_TCSR_REGS_XPU_MESRRESTORE_ADDR A:0x6193614c
y.create.l HWIO_TCSR_REGS_XPU_MESYNR0_ADDR A:0x61936150
y.create.l HWIO_TCSR_REGS_XPU_MESYNR1_ADDR A:0x61936154
y.create.l HWIO_TCSR_REGS_XPU_MESYNR2_ADDR A:0x61936158
y.create.l HWIO_TCSR_REGS_XPU_CR_ADDR A:0x61936080
y.create.l HWIO_TCSR_REGS_XPU_RPU_ACR0_ADDR A:0x619360a0
y.create.l HWIO_TCSR_REGS_XPU_EAR0_ADDR A:0x619360c0
y.create.l HWIO_TCSR_REGS_XPU_ESR_ADDR A:0x619360c8
y.create.l HWIO_TCSR_REGS_XPU_ESRRESTORE_ADDR A:0x619360cc
y.create.l HWIO_TCSR_REGS_XPU_ESYNR0_ADDR A:0x619360d0
y.create.l HWIO_TCSR_REGS_XPU_ESYNR1_ADDR A:0x619360d4
y.create.l HWIO_TCSR_REGS_XPU_ESYNR2_ADDR A:0x619360d8
y.create.l HWIO_TCSR_REGS_XPU_IDR0_ADDR A:0x61936074
y.create.l HWIO_TCSR_REGS_XPU_IDR1_ADDR A:0x61936078
y.create.l HWIO_TCSR_REGS_XPU_REV_ADDR A:0x6193607c
y.create.l HWIO_TCSR_REGS_XPU_RG0_RACR0_ADDR A:0x61936200
y.create.l HWIO_TCSR_REGS_XPU_RG1_RACR0_ADDR A:0x61936280
y.create.l HWIO_TCSR_REGS_XPU_RG2_RACR0_ADDR A:0x61936300
y.create.l HWIO_TCSR_REGS_XPU_RG3_RACR0_ADDR A:0x61936380
y.create.l HWIO_TCSR_REGS_XPU_RG4_RACR0_ADDR A:0x61936400
y.create.l HWIO_TCSR_REGS_XPU_RG5_RACR0_ADDR A:0x61936480
y.create.l HWIO_TCSR_REGS_XPU_RG6_RACR0_ADDR A:0x61936500
y.create.l HWIO_TCSR_REGS_XPU_RG7_RACR0_ADDR A:0x61936580
y.create.l HWIO_TCSR_REGS_XPU_RG8_RACR0_ADDR A:0x61936600
y.create.l HWIO_TCSR_REGS_XPU_RG9_RACR0_ADDR A:0x61936680
y.create.l HWIO_TCSR_REGS_XPU_RG0_WACR0_ADDR A:0x61936220
y.create.l HWIO_TCSR_REGS_XPU_RG1_WACR0_ADDR A:0x619362a0
y.create.l HWIO_TCSR_REGS_XPU_RG2_WACR0_ADDR A:0x61936320
y.create.l HWIO_TCSR_REGS_XPU_RG3_WACR0_ADDR A:0x619363a0
y.create.l HWIO_TCSR_REGS_XPU_RG4_WACR0_ADDR A:0x61936420
y.create.l HWIO_TCSR_REGS_XPU_RG5_WACR0_ADDR A:0x619364a0
y.create.l HWIO_TCSR_REGS_XPU_RG6_WACR0_ADDR A:0x61936520
y.create.l HWIO_TCSR_REGS_XPU_RG7_WACR0_ADDR A:0x619365a0
y.create.l HWIO_TCSR_REGS_XPU_RG8_WACR0_ADDR A:0x61936620
y.create.l HWIO_TCSR_REGS_XPU_RG9_WACR0_ADDR A:0x619366a0
y.create.l HWIO_TCSR_REGS_XPU_RG0_SCR_ADDR A:0x61936250
y.create.l HWIO_TCSR_REGS_XPU_RG1_SCR_ADDR A:0x619362d0
y.create.l HWIO_TCSR_REGS_XPU_RG2_SCR_ADDR A:0x61936350
y.create.l HWIO_TCSR_REGS_XPU_RG3_SCR_ADDR A:0x619363d0
y.create.l HWIO_TCSR_REGS_XPU_RG4_SCR_ADDR A:0x61936450
y.create.l HWIO_TCSR_REGS_XPU_RG5_SCR_ADDR A:0x619364d0
y.create.l HWIO_TCSR_REGS_XPU_RG6_SCR_ADDR A:0x61936550
y.create.l HWIO_TCSR_REGS_XPU_RG7_SCR_ADDR A:0x619365d0
y.create.l HWIO_TCSR_REGS_XPU_RG8_SCR_ADDR A:0x61936650
y.create.l HWIO_TCSR_REGS_XPU_RG9_SCR_ADDR A:0x619366d0
y.create.l HWIO_TCSR_REGS_XPU_RG0_MCR_ADDR A:0x61936254
y.create.l HWIO_TCSR_REGS_XPU_RG1_MCR_ADDR A:0x619362d4
y.create.l HWIO_TCSR_REGS_XPU_RG2_MCR_ADDR A:0x61936354
y.create.l HWIO_TCSR_REGS_XPU_RG3_MCR_ADDR A:0x619363d4
y.create.l HWIO_TCSR_REGS_XPU_RG4_MCR_ADDR A:0x61936454
y.create.l HWIO_TCSR_REGS_XPU_RG5_MCR_ADDR A:0x619364d4
y.create.l HWIO_TCSR_REGS_XPU_RG6_MCR_ADDR A:0x61936554
y.create.l HWIO_TCSR_REGS_XPU_RG7_MCR_ADDR A:0x619365d4
y.create.l HWIO_TCSR_REGS_XPU_RG8_MCR_ADDR A:0x61936654
y.create.l HWIO_TCSR_REGS_XPU_RG9_MCR_ADDR A:0x619366d4
y.create.l HWIO_TCSR_BIMC_CFG_QRIB_XPU2_INIT_ADDR A:0x61937100
y.create.l HWIO_TCSR_BIMC_QXS0_QRIB_XPU2_INIT_ADDR A:0x61937104
y.create.l HWIO_TCSR_BIMC_CFG_QRIB_XPU2_ACR_ADDR A:0x61938000
y.create.l HWIO_TCSR_BIMC_CFG_QRIB_XPU2_VMIDEN_INIT_ADDR A:0x61938004
y.create.l HWIO_TCSR_BIMC_QXS0_QRIB_XPU2_ACR_ADDR A:0x61938008
y.create.l HWIO_TCSR_BIMC_QXS0_QRIB_XPU2_VMIDEN_INIT_ADDR A:0x6193800c
y.create.l HWIO_TCSR_SS_XPU2_NON_SEC_INTR0_ADDR A:0x61939000
y.create.l HWIO_TCSR_SS_XPU2_NON_SEC_INTR0_ENABLE_ADDR A:0x61939040
y.create.l HWIO_TCSR_SS_VMIDMT_CLIENT_NON_SEC_INTR_ADDR A:0x61939010
y.create.l HWIO_TCSR_SS_VMIDMT_CLIENT_NON_SEC_INTR_ENABLE_ADDR A:0x61939050
y.create.l HWIO_TCSR_SS_VMIDMT_CFG_NON_SEC_INTR_ADDR A:0x61939090
y.create.l HWIO_TCSR_SS_VMIDMT_CFG_NON_SEC_INTR_ENABLE_ADDR A:0x619390d0
y.create.l HWIO_TCSR_MUTEX_REG_RESET_ADDR A:0x61939800
y.create.l HWIO_TCSR_SS_XPU2_SEC_INTR0_ADDR A:0x61939400
y.create.l HWIO_TCSR_SS_XPU2_SEC_INTR0_ENABLE_ADDR A:0x61939440
y.create.l HWIO_TCSR_SS_VMIDMT_CLIENT_SEC_INTR_ADDR A:0x61939410
y.create.l HWIO_TCSR_SS_VMIDMT_CLIENT_SEC_INTR_ENABLE_ADDR A:0x61939450
y.create.l HWIO_TCSR_SS_VMIDMT_CFG_SEC_INTR_ADDR A:0x61939490
y.create.l HWIO_TCSR_SS_VMIDMT_CFG_SEC_INTR_ENABLE_ADDR A:0x619394d0
y.create.l HWIO_TCSR_SS_XPU2_MSA_INTR0_ADDR A:0x6193a000
y.create.l HWIO_TCSR_SS_XPU2_MSA_INTR0_ENABLE_ADDR A:0x6193a010
y.create.l HWIO_TCSR_TCSR_CLK_EN_ADDR A:0x6193b07c
y.create.l HWIO_TCSR_TIMEOUT_SLAVE_GLB_EN_ADDR A:0x6193c000
y.create.l HWIO_TCSR_XPU_NSEN_STATUS_ADDR A:0x6193c004
y.create.l HWIO_TCSR_XPU_VMIDEN_STATUS_ADDR A:0x6193c008
y.create.l HWIO_TCSR_XPU_MSAEN_STATUS_ADDR A:0x6193c00c
y.create.l HWIO_TCSR_TZ_WONCE_0_ADDR A:0x6193d000
y.create.l HWIO_TCSR_TZ_WONCE_1_ADDR A:0x6193d004
y.create.l HWIO_TCSR_TZ_WONCE_2_ADDR A:0x6193d008
y.create.l HWIO_TCSR_TZ_WONCE_3_ADDR A:0x6193d00c
y.create.l HWIO_TCSR_TZ_WONCE_4_ADDR A:0x6193d010
y.create.l HWIO_TCSR_TZ_WONCE_5_ADDR A:0x6193d014
y.create.l HWIO_TCSR_TZ_WONCE_6_ADDR A:0x6193d018
y.create.l HWIO_TCSR_TZ_WONCE_7_ADDR A:0x6193d01c
y.create.l HWIO_TCSR_TZ_WONCE_8_ADDR A:0x6193d020
y.create.l HWIO_TCSR_TZ_WONCE_9_ADDR A:0x6193d024
y.create.l HWIO_TCSR_GCC_CLK_MUX_SEL_ADDR A:0x6193d0f0
y.create.l HWIO_TCSR_QPDI_DISABLE_CFG_ADDR A:0x61941000
y.create.l HWIO_TCSR_MSA_BIT_REG_ADDR A:0x6193a100
y.create.l HWIO_TCSR_BOOT_MISC_DETECT_ADDR A:0x6193d100
y.create.l HWIO_TCSR_APSS_VMID_ADDR A:0x6193d110
y.create.l HWIO_TCSR_MMSS_RPM_IRQ_EN_ADDR A:0x6193e000
y.create.l HWIO_TCSR_MMSS_RPM_IRQ_CLEAR_ADDR A:0x6193e004
y.create.l HWIO_TCSR_MMSS_RPM_IRQ_STATUS_ADDR A:0x6193e008
y.create.l HWIO_TCSR_MMSS_OXILI_GC_SYS_AHB_STATUS_ADDR A:0x6193e010
y.create.l HWIO_TCSR_MMSS_OXILI_CMD_REG_ADDR A:0x6193e014
y.create.l HWIO_TCSR_MMSS_DSI_ULP_CLAMP_CTRL_ADDR A:0x6193e020
y.create.l HWIO_TCSR_MMSS_IMEM_FSCGC_TIMERS_ADDR A:0x6193e030
y.create.l HWIO_TCSR_MMSS_IMEM_EX_FSCGC_CONTROL_ADDR A:0x6193e034
y.create.l HWIO_TCSR_MMSS_IMEM_RAM_CONFIG_ADDR A:0x6193e038
y.create.l HWIO_TCSR_TBU_BYPASS_ENABLE_ADDR A:0x6193f000
y.create.l HWIO_TCSR_SYS_POWER_CTRL_ADDR A:0x61947000
y.create.l HWIO_TCSR_USB_CORE_ID_ADDR A:0x61947004
y.create.l HWIO_TCSR_Q6_ISO_AXIM2_REQPEND_ADDR A:0x61947008
y.create.l HWIO_TCSR_TCSR_USB_PHY_MISC_ADDR A:0x61947240
y.create.l HWIO_TCSR_TCSR_USB_PHY_VLS_CLAMP_ADDR A:0x61947244
y.create.l HWIO_TCSR_LDO_SLEEP_CTRL_ADDR A:0x61948000
y.create.l HWIO_TCSR_LDO_UPDATE_STATE_CTRL_ADDR A:0x61948004
y.create.l HWIO_TCSR_LDO_OBIAS_CTRL_ADDR A:0x61948008
y.create.l HWIO_TCSR_LDO_VREF_CONFIG_ADDR A:0x6194800c
y.create.l HWIO_TCSR_LDO_IB_CONFIG_ADDR A:0x61948010
y.create.l HWIO_TCSR_LDO_BGC_CONFIG_ADDR A:0x61948014
y.create.l HWIO_TCSR_LDO_VREF_CTRL_ADDR A:0x61948018
y.create.l HWIO_TCSR_LDO_LD_EN_ADDR A:0x6194801c
y.create.l HWIO_TCSR_LDO_LD_CTRL_ADDR A:0x61948020
y.create.l HWIO_TCSR_LDO_OSC_RESETB_ADDR A:0x61948024
y.create.l HWIO_TCSR_LDO_OSC_CTRL_ADDR A:0x61948028
y.create.l HWIO_TCSR_LDO_DFT_EN_CTRL_ADDR A:0x6194802c
y.create.l HWIO_TCSR_LDO_DFT_CTRL_ADDR A:0x61948030
y.create.l HWIO_TCSR_MEM_ACC_SEL_VDDCX_ADDR A:0x61942100
y.create.l HWIO_TCSR_MEM_SVS_SEL_VDDCX_ADDR A:0x61942104
y.create.l HWIO_TCSR_SPDM_CNT_CLK_CTRL_ADDR A:0x6194a000
y.create.l HWIO_TCSR_SPDM_DLY_FIFO_EN_ADDR A:0x6194a004
y.create.l HWIO_TCSR_SPDM_STG1_MUX_SEL_ADDR A:0x6194a008
y.create.l HWIO_TCSR_SPDM_STG2_A_MUX_SEL_ADDR A:0x6194a00c
y.create.l HWIO_TCSR_SPDM_STG2_B_MUX_SEL_ADDR A:0x6194a010
y.create.l HWIO_TCSR_SPDM_STG3_A_MUX_SEL_ADDR A:0x6194a014
y.create.l HWIO_TCSR_SPDM_STG3_B_MUX_SEL_ADDR A:0x6194a018
y.create.l HWIO_TCSR_PHSS_UART_MSS_INT_SEL_0_ADDR A:0x6194b0c0
y.create.l HWIO_TCSR_PHSS_UART_MSS_INT_SEL_1_ADDR A:0x6194b0d0
y.create.l HWIO_TCSR_PHSS_QUP_MSS_INT_SEL_0_ADDR A:0x6194b140
y.create.l HWIO_TCSR_PHSS_QUP_MSS_INT_SEL_1_ADDR A:0x6194b150
y.create.l HWIO_TCSR_COMPILER_VDDMSS_ACC_0_ADDR A:0x61942000
y.create.l HWIO_TCSR_CUSTOM_ACC_4P_TYP1_VDDMSS_ADDR A:0x61942010
y.create.l HWIO_TCSR_CUSTOM_ACC_STDSP_0890_TYP2_VDDMSS_ADDR A:0x61942014
y.create.l HWIO_TCSR_CUSTOM_ACC_LLSP_0810_TYP3_VDDMSS_ADDR A:0x61942018
y.create.l HWIO_TCSR_CUSTOM_ACC_LLSP_0810_BOLT_TYP4_VDDMSS_ADDR A:0x6194201c
y.create.l HWIO_TCSR_COMPILER_VDDCX_ACC_0_ADDR A:0x61942080
y.create.l HWIO_TCSR_CUSTOM_ACC_4P_TYP1_VDDCX_ADDR A:0x61942090
y.create.l HWIO_TCSR_CUSTOM_ACC_STDSP_0890_TYP2_VDDCX_ADDR A:0x61942094
y.create.l HWIO_TCSR_CUSTOM_ACC_LLSP_0810_TYP3_VDDCX_ADDR A:0x61942098
y.create.l HWIO_TCSR_CUSTOM_ACC_LLSP_0810_BOLT_TYP4_VDDCX_ADDR A:0x6194209c
y.create.l HWIO_TCSR_COMPILER_Q6_ACC_0_ADDR A:0x619420b8
y.create.l HWIO_TCSR_MEM_ARRY_STBY_ADDR A:0x6194c180
y.create.l HWIO_TCSR_SOC_HW_VERSION_ADDR A:0x6194d000
y.create.l HWIO_TCSR_TIMEOUT_INTR_STATUS_ADDR A:0x6194d020
y.create.l HWIO_TCSR_TIMEOUT_INTR_RPM_ENABLE_ADDR A:0x6194d030
y.create.l HWIO_TCSR_TIMEOUT_INTR_APSS_ENABLE_ADDR A:0x6194d040
y.create.l HWIO_TCSR_TIMEOUT_INTR_MSS_ENABLE_ADDR A:0x6194d060
y.create.l HWIO_TCSR_PRONTO_BUS_TIMEOUT_RESET_ADDR A:0x6194d070
y.create.l HWIO_TCSR_CRYPTO0_HALTREQ_ADDR A:0x6194e000
y.create.l HWIO_TCSR_CRYPTO0_HALTACK_ADDR A:0x6194e004
y.create.l HWIO_TCSR_CRYPTO0_MASTER_IDLE_ADDR A:0x6194e008
y.create.l HWIO_TCSR_MSSQ6_HALTREQ_ADDR A:0x6194f000
y.create.l HWIO_TCSR_MSSQ6_HALTACK_ADDR A:0x6194f004
y.create.l HWIO_TCSR_MSSQ6_MASTER_IDLE_ADDR A:0x6194f008
y.create.l HWIO_TCSR_MSSQ6_POWER_STATE_ADDR A:0x6194f010
y.create.l HWIO_TCSR_MSS_OFFLINE_HALTREQ_ADDR A:0x61950000
y.create.l HWIO_TCSR_MSS_OFFLINE_HALTACK_ADDR A:0x61950004
y.create.l HWIO_TCSR_MSS_OFFLINE_MASTER_IDLE_ADDR A:0x61950008
y.create.l HWIO_TCSR_IPA_HALTREQ_ADDR A:0x61951000
y.create.l HWIO_TCSR_IPA_HALTACK_ADDR A:0x61951004
y.create.l HWIO_TCSR_MSSCE_HALTREQ_ADDR A:0x61952000
y.create.l HWIO_TCSR_MSSCE_HALTACK_ADDR A:0x61952004
y.create.l HWIO_TCSR_MSSCE_MASTER_IDLE_ADDR A:0x61952008
y.create.l HWIO_TCSR_SDC1_HALTREQ_ADDR A:0x61953000
y.create.l HWIO_TCSR_SDC1_HALTACK_ADDR A:0x61953004
y.create.l HWIO_TCSR_SDC1_MASTER_IDLE_ADDR A:0x61953008
y.create.l HWIO_TCSR_ULT_AUDIO_CORE_ABORT_REQ_ADDR A:0x61955000
y.create.l HWIO_TCSR_ULT_AUDIO_CORE_ABORT_ACK_ADDR A:0x61955004
y.create.l HWIO_TCSR_SPARE_APU_REG0_ADDR A:0x61946000
y.create.l HWIO_TCSR_SPARE_APU_REG1_ADDR A:0x61946004
y.create.l HWIO_TCSR_SPARE_APU_REG2_ADDR A:0x61946008
y.create.l HWIO_TCSR_SPARE_APU_REG3_ADDR A:0x6194600c
y.create.l HWIO_TCSR_SPARE_REG0_ADDR A:0x61956000
y.create.l HWIO_TCSR_SPARE_REG1_ADDR A:0x61956004
y.create.l HWIO_TCSR_SPARE_REG2_ADDR A:0x61956008
y.create.l HWIO_TCSR_SPARE_REG3_ADDR A:0x6195600c
y.create.l HWIO_TCSR_PNOC_SNOC_MEMTYPE_ADDR A:0x61957000
y.create.l HWIO_TCSR_RESET_DEBUG_SW_ENTRY_ADDR A:0x61940000
y.create.l HWIO_CRYPTO0_CRYPTO_VERSION_ADDR A:0x6073a000
y.create.l HWIO_CRYPTO0_CRYPTO_DATA_IN0_ADDR A:0x6073a010
y.create.l HWIO_CRYPTO0_CRYPTO_DATA_IN1_ADDR A:0x6073a014
y.create.l HWIO_CRYPTO0_CRYPTO_DATA_IN2_ADDR A:0x6073a018
y.create.l HWIO_CRYPTO0_CRYPTO_DATA_IN3_ADDR A:0x6073a01c
y.create.l HWIO_CRYPTO0_CRYPTO_DATA_OUT0_ADDR A:0x6073a020
y.create.l HWIO_CRYPTO0_CRYPTO_DATA_OUT1_ADDR A:0x6073a024
y.create.l HWIO_CRYPTO0_CRYPTO_DATA_OUT2_ADDR A:0x6073a028
y.create.l HWIO_CRYPTO0_CRYPTO_DATA_OUT3_ADDR A:0x6073a02c
y.create.l HWIO_CRYPTO0_CRYPTO_STATUS_ADDR A:0x6073a100
y.create.l HWIO_CRYPTO0_CRYPTO_STATUS2_ADDR A:0x6073a104
y.create.l HWIO_CRYPTO0_CRYPTO_ENGINES_AVAIL_ADDR A:0x6073a108
y.create.l HWIO_CRYPTO0_CRYPTO_FIFO_SIZES_ADDR A:0x6073a10c
y.create.l HWIO_CRYPTO0_CRYPTO_SEG_SIZE_ADDR A:0x6073a110
y.create.l HWIO_CRYPTO0_CRYPTO_GOPROC_ADDR A:0x6073a120
y.create.l HWIO_CRYPTO0_CRYPTO_GOPROC_QC_KEY_ADDR A:0x6073b000
y.create.l HWIO_CRYPTO0_CRYPTO_GOPROC_OEM_KEY_ADDR A:0x6073c000
y.create.l HWIO_CRYPTO0_CRYPTO_ENCR_SEG_CFG_ADDR A:0x6073a200
y.create.l HWIO_CRYPTO0_CRYPTO_ENCR_SEG_SIZE_ADDR A:0x6073a204
y.create.l HWIO_CRYPTO0_CRYPTO_ENCR_SEG_START_ADDR A:0x6073a208
y.create.l HWIO_CRYPTO0_CRYPTO_ENCR_KEY0_ADDR A:0x6073d000
y.create.l HWIO_CRYPTO0_CRYPTO_ENCR_KEY1_ADDR A:0x6073d004
y.create.l HWIO_CRYPTO0_CRYPTO_ENCR_KEY2_ADDR A:0x6073d008
y.create.l HWIO_CRYPTO0_CRYPTO_ENCR_KEY3_ADDR A:0x6073d00c
y.create.l HWIO_CRYPTO0_CRYPTO_ENCR_KEY4_ADDR A:0x6073d010
y.create.l HWIO_CRYPTO0_CRYPTO_ENCR_KEY5_ADDR A:0x6073d014
y.create.l HWIO_CRYPTO0_CRYPTO_ENCR_KEY6_ADDR A:0x6073d018
y.create.l HWIO_CRYPTO0_CRYPTO_ENCR_KEY7_ADDR A:0x6073d01c
y.create.l HWIO_CRYPTO0_CRYPTO_ENCR_PIPE0_KEY0_ADDR A:0x6073e000
y.create.l HWIO_CRYPTO0_CRYPTO_ENCR_PIPE0_KEY1_ADDR A:0x6073e004
y.create.l HWIO_CRYPTO0_CRYPTO_ENCR_PIPE0_KEY2_ADDR A:0x6073e008
y.create.l HWIO_CRYPTO0_CRYPTO_ENCR_PIPE0_KEY3_ADDR A:0x6073e00c
y.create.l HWIO_CRYPTO0_CRYPTO_ENCR_PIPE1_KEY0_ADDR A:0x6073e020
y.create.l HWIO_CRYPTO0_CRYPTO_ENCR_PIPE1_KEY1_ADDR A:0x6073e024
y.create.l HWIO_CRYPTO0_CRYPTO_ENCR_PIPE1_KEY2_ADDR A:0x6073e028
y.create.l HWIO_CRYPTO0_CRYPTO_ENCR_PIPE1_KEY3_ADDR A:0x6073e02c
y.create.l HWIO_CRYPTO0_CRYPTO_ENCR_PIPE2_KEY0_ADDR A:0x6073e040
y.create.l HWIO_CRYPTO0_CRYPTO_ENCR_PIPE2_KEY1_ADDR A:0x6073e044
y.create.l HWIO_CRYPTO0_CRYPTO_ENCR_PIPE2_KEY2_ADDR A:0x6073e048
y.create.l HWIO_CRYPTO0_CRYPTO_ENCR_PIPE2_KEY3_ADDR A:0x6073e04c
y.create.l HWIO_CRYPTO0_CRYPTO_ENCR_PIPE3_KEY0_ADDR A:0x6073e060
y.create.l HWIO_CRYPTO0_CRYPTO_ENCR_PIPE3_KEY1_ADDR A:0x6073e064
y.create.l HWIO_CRYPTO0_CRYPTO_ENCR_PIPE3_KEY2_ADDR A:0x6073e068
y.create.l HWIO_CRYPTO0_CRYPTO_ENCR_PIPE3_KEY3_ADDR A:0x6073e06c
y.create.l HWIO_CRYPTO0_CRYPTO_ENCR_XTS_KEY0_ADDR A:0x6073d020
y.create.l HWIO_CRYPTO0_CRYPTO_ENCR_XTS_KEY1_ADDR A:0x6073d024
y.create.l HWIO_CRYPTO0_CRYPTO_ENCR_XTS_KEY2_ADDR A:0x6073d028
y.create.l HWIO_CRYPTO0_CRYPTO_ENCR_XTS_KEY3_ADDR A:0x6073d02c
y.create.l HWIO_CRYPTO0_CRYPTO_ENCR_XTS_KEY4_ADDR A:0x6073d030
y.create.l HWIO_CRYPTO0_CRYPTO_ENCR_XTS_KEY5_ADDR A:0x6073d034
y.create.l HWIO_CRYPTO0_CRYPTO_ENCR_XTS_KEY6_ADDR A:0x6073d038
y.create.l HWIO_CRYPTO0_CRYPTO_ENCR_XTS_KEY7_ADDR A:0x6073d03c
y.create.l HWIO_CRYPTO0_CRYPTO_ENCR_PIPE0_XTS_KEY0_ADDR A:0x6073e200
y.create.l HWIO_CRYPTO0_CRYPTO_ENCR_PIPE0_XTS_KEY1_ADDR A:0x6073e204
y.create.l HWIO_CRYPTO0_CRYPTO_ENCR_PIPE0_XTS_KEY2_ADDR A:0x6073e208
y.create.l HWIO_CRYPTO0_CRYPTO_ENCR_PIPE0_XTS_KEY3_ADDR A:0x6073e20c
y.create.l HWIO_CRYPTO0_CRYPTO_ENCR_PIPE1_XTS_KEY0_ADDR A:0x6073e220
y.create.l HWIO_CRYPTO0_CRYPTO_ENCR_PIPE1_XTS_KEY1_ADDR A:0x6073e224
y.create.l HWIO_CRYPTO0_CRYPTO_ENCR_PIPE1_XTS_KEY2_ADDR A:0x6073e228
y.create.l HWIO_CRYPTO0_CRYPTO_ENCR_PIPE1_XTS_KEY3_ADDR A:0x6073e22c
y.create.l HWIO_CRYPTO0_CRYPTO_ENCR_PIPE2_XTS_KEY0_ADDR A:0x6073e240
y.create.l HWIO_CRYPTO0_CRYPTO_ENCR_PIPE2_XTS_KEY1_ADDR A:0x6073e244
y.create.l HWIO_CRYPTO0_CRYPTO_ENCR_PIPE2_XTS_KEY2_ADDR A:0x6073e248
y.create.l HWIO_CRYPTO0_CRYPTO_ENCR_PIPE2_XTS_KEY3_ADDR A:0x6073e24c
y.create.l HWIO_CRYPTO0_CRYPTO_ENCR_PIPE3_XTS_KEY0_ADDR A:0x6073e260
y.create.l HWIO_CRYPTO0_CRYPTO_ENCR_PIPE3_XTS_KEY1_ADDR A:0x6073e264
y.create.l HWIO_CRYPTO0_CRYPTO_ENCR_PIPE3_XTS_KEY2_ADDR A:0x6073e268
y.create.l HWIO_CRYPTO0_CRYPTO_ENCR_PIPE3_XTS_KEY3_ADDR A:0x6073e26c
y.create.l HWIO_CRYPTO0_CRYPTO_ENCR_PIPE0_ODD_KEY0_ADDR A:0x6073e400
y.create.l HWIO_CRYPTO0_CRYPTO_ENCR_PIPE0_ODD_KEY1_ADDR A:0x6073e404
y.create.l HWIO_CRYPTO0_CRYPTO_ENCR_PIPE0_ODD_KEY2_ADDR A:0x6073e408
y.create.l HWIO_CRYPTO0_CRYPTO_ENCR_PIPE0_ODD_KEY3_ADDR A:0x6073e40c
y.create.l HWIO_CRYPTO0_CRYPTO_ENCR_PIPE1_ODD_KEY0_ADDR A:0x6073e420
y.create.l HWIO_CRYPTO0_CRYPTO_ENCR_PIPE1_ODD_KEY1_ADDR A:0x6073e424
y.create.l HWIO_CRYPTO0_CRYPTO_ENCR_PIPE1_ODD_KEY2_ADDR A:0x6073e428
y.create.l HWIO_CRYPTO0_CRYPTO_ENCR_PIPE1_ODD_KEY3_ADDR A:0x6073e42c
y.create.l HWIO_CRYPTO0_CRYPTO_ENCR_PIPE2_ODD_KEY0_ADDR A:0x6073e440
y.create.l HWIO_CRYPTO0_CRYPTO_ENCR_PIPE2_ODD_KEY1_ADDR A:0x6073e444
y.create.l HWIO_CRYPTO0_CRYPTO_ENCR_PIPE2_ODD_KEY2_ADDR A:0x6073e448
y.create.l HWIO_CRYPTO0_CRYPTO_ENCR_PIPE2_ODD_KEY3_ADDR A:0x6073e44c
y.create.l HWIO_CRYPTO0_CRYPTO_ENCR_PIPE3_ODD_KEY0_ADDR A:0x6073e460
y.create.l HWIO_CRYPTO0_CRYPTO_ENCR_PIPE3_ODD_KEY1_ADDR A:0x6073e464
y.create.l HWIO_CRYPTO0_CRYPTO_ENCR_PIPE3_ODD_KEY2_ADDR A:0x6073e468
y.create.l HWIO_CRYPTO0_CRYPTO_ENCR_PIPE3_ODD_KEY3_ADDR A:0x6073e46c
y.create.l HWIO_CRYPTO0_CRYPTO_ENCR_PIPE0_XTS_ODD_KEY0_ADDR A:0x6073e600
y.create.l HWIO_CRYPTO0_CRYPTO_ENCR_PIPE0_XTS_ODD_KEY1_ADDR A:0x6073e604
y.create.l HWIO_CRYPTO0_CRYPTO_ENCR_PIPE0_XTS_ODD_KEY2_ADDR A:0x6073e608
y.create.l HWIO_CRYPTO0_CRYPTO_ENCR_PIPE0_XTS_ODD_KEY3_ADDR A:0x6073e60c
y.create.l HWIO_CRYPTO0_CRYPTO_ENCR_PIPE1_XTS_ODD_KEY0_ADDR A:0x6073e620
y.create.l HWIO_CRYPTO0_CRYPTO_ENCR_PIPE1_XTS_ODD_KEY1_ADDR A:0x6073e624
y.create.l HWIO_CRYPTO0_CRYPTO_ENCR_PIPE1_XTS_ODD_KEY2_ADDR A:0x6073e628
y.create.l HWIO_CRYPTO0_CRYPTO_ENCR_PIPE1_XTS_ODD_KEY3_ADDR A:0x6073e62c
y.create.l HWIO_CRYPTO0_CRYPTO_ENCR_PIPE2_XTS_ODD_KEY0_ADDR A:0x6073e640
y.create.l HWIO_CRYPTO0_CRYPTO_ENCR_PIPE2_XTS_ODD_KEY1_ADDR A:0x6073e644
y.create.l HWIO_CRYPTO0_CRYPTO_ENCR_PIPE2_XTS_ODD_KEY2_ADDR A:0x6073e648
y.create.l HWIO_CRYPTO0_CRYPTO_ENCR_PIPE2_XTS_ODD_KEY3_ADDR A:0x6073e64c
y.create.l HWIO_CRYPTO0_CRYPTO_ENCR_PIPE3_XTS_ODD_KEY0_ADDR A:0x6073e660
y.create.l HWIO_CRYPTO0_CRYPTO_ENCR_PIPE3_XTS_ODD_KEY1_ADDR A:0x6073e664
y.create.l HWIO_CRYPTO0_CRYPTO_ENCR_PIPE3_XTS_ODD_KEY2_ADDR A:0x6073e668
y.create.l HWIO_CRYPTO0_CRYPTO_ENCR_PIPE3_XTS_ODD_KEY3_ADDR A:0x6073e66c
y.create.l HWIO_CRYPTO0_CRYPTO_ENCR_CNTR0_IV0_ADDR A:0x6073a20c
y.create.l HWIO_CRYPTO0_CRYPTO_ENCR_CNTR1_IV1_ADDR A:0x6073a210
y.create.l HWIO_CRYPTO0_CRYPTO_ENCR_CNTR2_IV2_ADDR A:0x6073a214
y.create.l HWIO_CRYPTO0_CRYPTO_ENCR_CNTR3_IV3_ADDR A:0x6073a218
y.create.l HWIO_CRYPTO0_CRYPTO_ENCR_CNTR_MASK_ADDR A:0x6073a21c
y.create.l HWIO_CRYPTO0_CRYPTO_ENCR_CNTR_MASK2_ADDR A:0x6073a234
y.create.l HWIO_CRYPTO0_CRYPTO_ENCR_CNTR_MASK1_ADDR A:0x6073a238
y.create.l HWIO_CRYPTO0_CRYPTO_ENCR_CNTR_MASK0_ADDR A:0x6073a23c
y.create.l HWIO_CRYPTO0_CRYPTO_ENCR_CCM_INIT_CNTR0_ADDR A:0x6073a220
y.create.l HWIO_CRYPTO0_CRYPTO_ENCR_CCM_INIT_CNTR1_ADDR A:0x6073a224
y.create.l HWIO_CRYPTO0_CRYPTO_ENCR_CCM_INIT_CNTR2_ADDR A:0x6073a228
y.create.l HWIO_CRYPTO0_CRYPTO_ENCR_CCM_INIT_CNTR3_ADDR A:0x6073a22c
y.create.l HWIO_CRYPTO0_CRYPTO_ENCR_XTS_DU_SIZE_ADDR A:0x6073a230
y.create.l HWIO_CRYPTO0_CRYPTO_AUTH_SEG_CFG_ADDR A:0x6073a300
y.create.l HWIO_CRYPTO0_CRYPTO_AUTH_SEG_SIZE_ADDR A:0x6073a304
y.create.l HWIO_CRYPTO0_CRYPTO_AUTH_SEG_START_ADDR A:0x6073a308
y.create.l HWIO_CRYPTO0_CRYPTO_AUTH_KEY0_ADDR A:0x6073d040
y.create.l HWIO_CRYPTO0_CRYPTO_AUTH_KEY1_ADDR A:0x6073d044
y.create.l HWIO_CRYPTO0_CRYPTO_AUTH_KEY2_ADDR A:0x6073d048
y.create.l HWIO_CRYPTO0_CRYPTO_AUTH_KEY3_ADDR A:0x6073d04c
y.create.l HWIO_CRYPTO0_CRYPTO_AUTH_KEY4_ADDR A:0x6073d050
y.create.l HWIO_CRYPTO0_CRYPTO_AUTH_KEY5_ADDR A:0x6073d054
y.create.l HWIO_CRYPTO0_CRYPTO_AUTH_KEY6_ADDR A:0x6073d058
y.create.l HWIO_CRYPTO0_CRYPTO_AUTH_KEY7_ADDR A:0x6073d05c
y.create.l HWIO_CRYPTO0_CRYPTO_AUTH_KEY8_ADDR A:0x6073d060
y.create.l HWIO_CRYPTO0_CRYPTO_AUTH_KEY9_ADDR A:0x6073d064
y.create.l HWIO_CRYPTO0_CRYPTO_AUTH_PIPE0_KEY0_ADDR A:0x6073e800
y.create.l HWIO_CRYPTO0_CRYPTO_AUTH_PIPE0_KEY1_ADDR A:0x6073e804
y.create.l HWIO_CRYPTO0_CRYPTO_AUTH_PIPE0_KEY2_ADDR A:0x6073e808
y.create.l HWIO_CRYPTO0_CRYPTO_AUTH_PIPE0_KEY3_ADDR A:0x6073e80c
y.create.l HWIO_CRYPTO0_CRYPTO_AUTH_PIPE1_KEY0_ADDR A:0x6073e880
y.create.l HWIO_CRYPTO0_CRYPTO_AUTH_PIPE1_KEY1_ADDR A:0x6073e884
y.create.l HWIO_CRYPTO0_CRYPTO_AUTH_PIPE1_KEY2_ADDR A:0x6073e888
y.create.l HWIO_CRYPTO0_CRYPTO_AUTH_PIPE1_KEY3_ADDR A:0x6073e88c
y.create.l HWIO_CRYPTO0_CRYPTO_AUTH_PIPE2_KEY0_ADDR A:0x6073e900
y.create.l HWIO_CRYPTO0_CRYPTO_AUTH_PIPE2_KEY1_ADDR A:0x6073e904
y.create.l HWIO_CRYPTO0_CRYPTO_AUTH_PIPE2_KEY2_ADDR A:0x6073e908
y.create.l HWIO_CRYPTO0_CRYPTO_AUTH_PIPE2_KEY3_ADDR A:0x6073e90c
y.create.l HWIO_CRYPTO0_CRYPTO_AUTH_PIPE3_KEY0_ADDR A:0x6073e980
y.create.l HWIO_CRYPTO0_CRYPTO_AUTH_PIPE3_KEY1_ADDR A:0x6073e984
y.create.l HWIO_CRYPTO0_CRYPTO_AUTH_PIPE3_KEY2_ADDR A:0x6073e988
y.create.l HWIO_CRYPTO0_CRYPTO_AUTH_PIPE3_KEY3_ADDR A:0x6073e98c
y.create.l HWIO_CRYPTO0_CRYPTO_AUTH_IV0_ADDR A:0x6073a310
y.create.l HWIO_CRYPTO0_CRYPTO_AUTH_IV1_ADDR A:0x6073a314
y.create.l HWIO_CRYPTO0_CRYPTO_AUTH_IV2_ADDR A:0x6073a318
y.create.l HWIO_CRYPTO0_CRYPTO_AUTH_IV3_ADDR A:0x6073a31c
y.create.l HWIO_CRYPTO0_CRYPTO_AUTH_IV4_ADDR A:0x6073a320
y.create.l HWIO_CRYPTO0_CRYPTO_AUTH_IV5_ADDR A:0x6073a324
y.create.l HWIO_CRYPTO0_CRYPTO_AUTH_IV6_ADDR A:0x6073a328
y.create.l HWIO_CRYPTO0_CRYPTO_AUTH_IV7_ADDR A:0x6073a32c
y.create.l HWIO_CRYPTO0_CRYPTO_AUTH_INFO_NONCE0_ADDR A:0x6073a350
y.create.l HWIO_CRYPTO0_CRYPTO_AUTH_INFO_NONCE1_ADDR A:0x6073a354
y.create.l HWIO_CRYPTO0_CRYPTO_AUTH_INFO_NONCE2_ADDR A:0x6073a358
y.create.l HWIO_CRYPTO0_CRYPTO_AUTH_INFO_NONCE3_ADDR A:0x6073a35c
y.create.l HWIO_CRYPTO0_CRYPTO_AUTH_BYTECNT0_ADDR A:0x6073a390
y.create.l HWIO_CRYPTO0_CRYPTO_AUTH_BYTECNT1_ADDR A:0x6073a394
y.create.l HWIO_CRYPTO0_CRYPTO_AUTH_EXP_MAC0_ADDR A:0x6073a3a0
y.create.l HWIO_CRYPTO0_CRYPTO_AUTH_EXP_MAC1_ADDR A:0x6073a3a4
y.create.l HWIO_CRYPTO0_CRYPTO_AUTH_EXP_MAC2_ADDR A:0x6073a3a8
y.create.l HWIO_CRYPTO0_CRYPTO_AUTH_EXP_MAC3_ADDR A:0x6073a3ac
y.create.l HWIO_CRYPTO0_CRYPTO_AUTH_EXP_MAC4_ADDR A:0x6073a3b0
y.create.l HWIO_CRYPTO0_CRYPTO_AUTH_EXP_MAC5_ADDR A:0x6073a3b4
y.create.l HWIO_CRYPTO0_CRYPTO_AUTH_EXP_MAC6_ADDR A:0x6073a3b8
y.create.l HWIO_CRYPTO0_CRYPTO_AUTH_EXP_MAC7_ADDR A:0x6073a3bc
y.create.l HWIO_CRYPTO0_CRYPTO_CONFIG_ADDR A:0x6073a400
y.create.l HWIO_CRYPTO0_CRYPTO_DEBUG_ENABLE_ADDR A:0x6073f000
y.create.l HWIO_CRYPTO0_CRYPTO_DEBUG_ADDR A:0x6073f004
y.create.l HWIO_CRYPTO0_CRYPTO_PWR_CTRL_ADDR A:0x6073f008
y.create.l HWIO_CRYPTO0_CRYPTO_BAM_CTRL_ADDR A:0x60704000
y.create.l HWIO_CRYPTO0_CRYPTO_BAM_TIMER_ADDR A:0x60704040
y.create.l HWIO_CRYPTO0_CRYPTO_BAM_TIMER_CTRL_ADDR A:0x60704044
y.create.l HWIO_CRYPTO0_CRYPTO_BAM_DESC_CNT_TRSHLD_ADDR A:0x60704008
y.create.l HWIO_CRYPTO0_CRYPTO_BAM_IRQ_STTS_ADDR A:0x60704014
y.create.l HWIO_CRYPTO0_CRYPTO_BAM_IRQ_CLR_ADDR A:0x60704018
y.create.l HWIO_CRYPTO0_CRYPTO_BAM_IRQ_EN_ADDR A:0x6070401c
y.create.l HWIO_CRYPTO0_CRYPTO_BAM_CNFG_BITS_ADDR A:0x6070407c
y.create.l HWIO_CRYPTO0_CRYPTO_BAM_CNFG_BITS_2_ADDR A:0x60704084
y.create.l HWIO_CRYPTO0_CRYPTO_BAM_REVISION_ADDR A:0x60705000
y.create.l HWIO_CRYPTO0_CRYPTO_BAM_SW_VERSION_ADDR A:0x60705004
y.create.l HWIO_CRYPTO0_CRYPTO_BAM_NUM_PIPES_ADDR A:0x60705008
y.create.l HWIO_CRYPTO0_CRYPTO_BAM_TEST_BUS_SEL_ADDR A:0x60705010
y.create.l HWIO_CRYPTO0_CRYPTO_BAM_TEST_BUS_REG_ADDR A:0x60705014
y.create.l HWIO_CRYPTO0_CRYPTO_BAM_AHB_MASTER_ERR_CTRLS_ADDR A:0x60705024
y.create.l HWIO_CRYPTO0_CRYPTO_BAM_AHB_MASTER_ERR_ADDR_ADDR A:0x60705028
y.create.l HWIO_CRYPTO0_CRYPTO_BAM_AHB_MASTER_ERR_DATA_ADDR A:0x6070502c
y.create.l HWIO_CRYPTO0_CRYPTO_BAM_AHB_MASTER_ERR_ADDR_LSB_ADDR A:0x60705100
y.create.l HWIO_CRYPTO0_CRYPTO_BAM_AHB_MASTER_ERR_ADDR_MSB_ADDR A:0x60705104
y.create.l HWIO_CRYPTO0_CRYPTO_BAM_TRUST_REG_ADDR A:0x60706000
y.create.l HWIO_CRYPTO0_CRYPTO_BAM_P_TRUST_REG0_ADDR A:0x60706020
y.create.l HWIO_CRYPTO0_CRYPTO_BAM_P_TRUST_REG1_ADDR A:0x60706024
y.create.l HWIO_CRYPTO0_CRYPTO_BAM_P_TRUST_REG2_ADDR A:0x60706028
y.create.l HWIO_CRYPTO0_CRYPTO_BAM_P_TRUST_REG3_ADDR A:0x6070602c
y.create.l HWIO_CRYPTO0_CRYPTO_BAM_P_TRUST_REG4_ADDR A:0x60706030
y.create.l HWIO_CRYPTO0_CRYPTO_BAM_P_TRUST_REG5_ADDR A:0x60706034
y.create.l HWIO_CRYPTO0_CRYPTO_BAM_P_TRUST_REG6_ADDR A:0x60706038
y.create.l HWIO_CRYPTO0_CRYPTO_BAM_P_TRUST_REG7_ADDR A:0x6070603c
y.create.l HWIO_CRYPTO0_CRYPTO_BAM_IRQ_SRCS_EE0_ADDR A:0x60707000
y.create.l HWIO_CRYPTO0_CRYPTO_BAM_IRQ_SRCS_EE1_ADDR A:0x60708000
y.create.l HWIO_CRYPTO0_CRYPTO_BAM_IRQ_SRCS_EE2_ADDR A:0x60709000
y.create.l HWIO_CRYPTO0_CRYPTO_BAM_IRQ_SRCS_EE3_ADDR A:0x6070a000
y.create.l HWIO_CRYPTO0_CRYPTO_BAM_IRQ_SRCS_EE4_ADDR A:0x6070b000
y.create.l HWIO_CRYPTO0_CRYPTO_BAM_IRQ_SRCS_EE5_ADDR A:0x6070c000
y.create.l HWIO_CRYPTO0_CRYPTO_BAM_IRQ_SRCS_EE6_ADDR A:0x6070d000
y.create.l HWIO_CRYPTO0_CRYPTO_BAM_IRQ_SRCS_EE7_ADDR A:0x6070e000
y.create.l HWIO_CRYPTO0_CRYPTO_BAM_IRQ_SRCS_MSK_EE0_ADDR A:0x60707004
y.create.l HWIO_CRYPTO0_CRYPTO_BAM_IRQ_SRCS_MSK_EE1_ADDR A:0x60708004
y.create.l HWIO_CRYPTO0_CRYPTO_BAM_IRQ_SRCS_MSK_EE2_ADDR A:0x60709004
y.create.l HWIO_CRYPTO0_CRYPTO_BAM_IRQ_SRCS_MSK_EE3_ADDR A:0x6070a004
y.create.l HWIO_CRYPTO0_CRYPTO_BAM_IRQ_SRCS_MSK_EE4_ADDR A:0x6070b004
y.create.l HWIO_CRYPTO0_CRYPTO_BAM_IRQ_SRCS_MSK_EE5_ADDR A:0x6070c004
y.create.l HWIO_CRYPTO0_CRYPTO_BAM_IRQ_SRCS_MSK_EE6_ADDR A:0x6070d004
y.create.l HWIO_CRYPTO0_CRYPTO_BAM_IRQ_SRCS_MSK_EE7_ADDR A:0x6070e004
y.create.l HWIO_CRYPTO0_CRYPTO_BAM_IRQ_SRCS_UNMASKED_EE0_ADDR A:0x60707008
y.create.l HWIO_CRYPTO0_CRYPTO_BAM_IRQ_SRCS_UNMASKED_EE1_ADDR A:0x60708008
y.create.l HWIO_CRYPTO0_CRYPTO_BAM_IRQ_SRCS_UNMASKED_EE2_ADDR A:0x60709008
y.create.l HWIO_CRYPTO0_CRYPTO_BAM_IRQ_SRCS_UNMASKED_EE3_ADDR A:0x6070a008
y.create.l HWIO_CRYPTO0_CRYPTO_BAM_IRQ_SRCS_UNMASKED_EE4_ADDR A:0x6070b008
y.create.l HWIO_CRYPTO0_CRYPTO_BAM_IRQ_SRCS_UNMASKED_EE5_ADDR A:0x6070c008
y.create.l HWIO_CRYPTO0_CRYPTO_BAM_IRQ_SRCS_UNMASKED_EE6_ADDR A:0x6070d008
y.create.l HWIO_CRYPTO0_CRYPTO_BAM_IRQ_SRCS_UNMASKED_EE7_ADDR A:0x6070e008
y.create.l HWIO_CRYPTO0_CRYPTO_BAM_PIPE_ATTR_EE0_ADDR A:0x6070700c
y.create.l HWIO_CRYPTO0_CRYPTO_BAM_PIPE_ATTR_EE1_ADDR A:0x6070800c
y.create.l HWIO_CRYPTO0_CRYPTO_BAM_PIPE_ATTR_EE2_ADDR A:0x6070900c
y.create.l HWIO_CRYPTO0_CRYPTO_BAM_PIPE_ATTR_EE3_ADDR A:0x6070a00c
y.create.l HWIO_CRYPTO0_CRYPTO_BAM_PIPE_ATTR_EE4_ADDR A:0x6070b00c
y.create.l HWIO_CRYPTO0_CRYPTO_BAM_PIPE_ATTR_EE5_ADDR A:0x6070c00c
y.create.l HWIO_CRYPTO0_CRYPTO_BAM_PIPE_ATTR_EE6_ADDR A:0x6070d00c
y.create.l HWIO_CRYPTO0_CRYPTO_BAM_PIPE_ATTR_EE7_ADDR A:0x6070e00c
y.create.l HWIO_CRYPTO0_CRYPTO_BAM_IRQ_SRCS_ADDR A:0x60707010
y.create.l HWIO_CRYPTO0_CRYPTO_BAM_IRQ_SRCS_MSK_ADDR A:0x60707014
y.create.l HWIO_CRYPTO0_CRYPTO_BAM_IRQ_SRCS_UNMASKED_ADDR A:0x60707018
y.create.l HWIO_CRYPTO0_CRYPTO_BAM_P_CTRL0_ADDR A:0x60717000
y.create.l HWIO_CRYPTO0_CRYPTO_BAM_P_CTRL1_ADDR A:0x60718000
y.create.l HWIO_CRYPTO0_CRYPTO_BAM_P_CTRL2_ADDR A:0x60719000
y.create.l HWIO_CRYPTO0_CRYPTO_BAM_P_CTRL3_ADDR A:0x6071a000
y.create.l HWIO_CRYPTO0_CRYPTO_BAM_P_CTRL4_ADDR A:0x6071b000
y.create.l HWIO_CRYPTO0_CRYPTO_BAM_P_CTRL5_ADDR A:0x6071c000
y.create.l HWIO_CRYPTO0_CRYPTO_BAM_P_CTRL6_ADDR A:0x6071d000
y.create.l HWIO_CRYPTO0_CRYPTO_BAM_P_CTRL7_ADDR A:0x6071e000
y.create.l HWIO_CRYPTO0_CRYPTO_BAM_P_RST0_ADDR A:0x60717004
y.create.l HWIO_CRYPTO0_CRYPTO_BAM_P_RST1_ADDR A:0x60718004
y.create.l HWIO_CRYPTO0_CRYPTO_BAM_P_RST2_ADDR A:0x60719004
y.create.l HWIO_CRYPTO0_CRYPTO_BAM_P_RST3_ADDR A:0x6071a004
y.create.l HWIO_CRYPTO0_CRYPTO_BAM_P_RST4_ADDR A:0x6071b004
y.create.l HWIO_CRYPTO0_CRYPTO_BAM_P_RST5_ADDR A:0x6071c004
y.create.l HWIO_CRYPTO0_CRYPTO_BAM_P_RST6_ADDR A:0x6071d004
y.create.l HWIO_CRYPTO0_CRYPTO_BAM_P_RST7_ADDR A:0x6071e004
y.create.l HWIO_CRYPTO0_CRYPTO_BAM_P_HALT0_ADDR A:0x60717008
y.create.l HWIO_CRYPTO0_CRYPTO_BAM_P_HALT1_ADDR A:0x60718008
y.create.l HWIO_CRYPTO0_CRYPTO_BAM_P_HALT2_ADDR A:0x60719008
y.create.l HWIO_CRYPTO0_CRYPTO_BAM_P_HALT3_ADDR A:0x6071a008
y.create.l HWIO_CRYPTO0_CRYPTO_BAM_P_HALT4_ADDR A:0x6071b008
y.create.l HWIO_CRYPTO0_CRYPTO_BAM_P_HALT5_ADDR A:0x6071c008
y.create.l HWIO_CRYPTO0_CRYPTO_BAM_P_HALT6_ADDR A:0x6071d008
y.create.l HWIO_CRYPTO0_CRYPTO_BAM_P_HALT7_ADDR A:0x6071e008
y.create.l HWIO_CRYPTO0_CRYPTO_BAM_P_IRQ_STTS0_ADDR A:0x60717010
y.create.l HWIO_CRYPTO0_CRYPTO_BAM_P_IRQ_STTS1_ADDR A:0x60718010
y.create.l HWIO_CRYPTO0_CRYPTO_BAM_P_IRQ_STTS2_ADDR A:0x60719010
y.create.l HWIO_CRYPTO0_CRYPTO_BAM_P_IRQ_STTS3_ADDR A:0x6071a010
y.create.l HWIO_CRYPTO0_CRYPTO_BAM_P_IRQ_STTS4_ADDR A:0x6071b010
y.create.l HWIO_CRYPTO0_CRYPTO_BAM_P_IRQ_STTS5_ADDR A:0x6071c010
y.create.l HWIO_CRYPTO0_CRYPTO_BAM_P_IRQ_STTS6_ADDR A:0x6071d010
y.create.l HWIO_CRYPTO0_CRYPTO_BAM_P_IRQ_STTS7_ADDR A:0x6071e010
y.create.l HWIO_CRYPTO0_CRYPTO_BAM_P_IRQ_CLR0_ADDR A:0x60717014
y.create.l HWIO_CRYPTO0_CRYPTO_BAM_P_IRQ_CLR1_ADDR A:0x60718014
y.create.l HWIO_CRYPTO0_CRYPTO_BAM_P_IRQ_CLR2_ADDR A:0x60719014
y.create.l HWIO_CRYPTO0_CRYPTO_BAM_P_IRQ_CLR3_ADDR A:0x6071a014
y.create.l HWIO_CRYPTO0_CRYPTO_BAM_P_IRQ_CLR4_ADDR A:0x6071b014
y.create.l HWIO_CRYPTO0_CRYPTO_BAM_P_IRQ_CLR5_ADDR A:0x6071c014
y.create.l HWIO_CRYPTO0_CRYPTO_BAM_P_IRQ_CLR6_ADDR A:0x6071d014
y.create.l HWIO_CRYPTO0_CRYPTO_BAM_P_IRQ_CLR7_ADDR A:0x6071e014
y.create.l HWIO_CRYPTO0_CRYPTO_BAM_P_IRQ_EN0_ADDR A:0x60717018
y.create.l HWIO_CRYPTO0_CRYPTO_BAM_P_IRQ_EN1_ADDR A:0x60718018
y.create.l HWIO_CRYPTO0_CRYPTO_BAM_P_IRQ_EN2_ADDR A:0x60719018
y.create.l HWIO_CRYPTO0_CRYPTO_BAM_P_IRQ_EN3_ADDR A:0x6071a018
y.create.l HWIO_CRYPTO0_CRYPTO_BAM_P_IRQ_EN4_ADDR A:0x6071b018
y.create.l HWIO_CRYPTO0_CRYPTO_BAM_P_IRQ_EN5_ADDR A:0x6071c018
y.create.l HWIO_CRYPTO0_CRYPTO_BAM_P_IRQ_EN6_ADDR A:0x6071d018
y.create.l HWIO_CRYPTO0_CRYPTO_BAM_P_IRQ_EN7_ADDR A:0x6071e018
y.create.l HWIO_CRYPTO0_CRYPTO_BAM_P_TIMER0_ADDR A:0x6071701c
y.create.l HWIO_CRYPTO0_CRYPTO_BAM_P_TIMER1_ADDR A:0x6071801c
y.create.l HWIO_CRYPTO0_CRYPTO_BAM_P_TIMER2_ADDR A:0x6071901c
y.create.l HWIO_CRYPTO0_CRYPTO_BAM_P_TIMER3_ADDR A:0x6071a01c
y.create.l HWIO_CRYPTO0_CRYPTO_BAM_P_TIMER4_ADDR A:0x6071b01c
y.create.l HWIO_CRYPTO0_CRYPTO_BAM_P_TIMER5_ADDR A:0x6071c01c
y.create.l HWIO_CRYPTO0_CRYPTO_BAM_P_TIMER6_ADDR A:0x6071d01c
y.create.l HWIO_CRYPTO0_CRYPTO_BAM_P_TIMER7_ADDR A:0x6071e01c
y.create.l HWIO_CRYPTO0_CRYPTO_BAM_P_TIMER_CTRL0_ADDR A:0x60717020
y.create.l HWIO_CRYPTO0_CRYPTO_BAM_P_TIMER_CTRL1_ADDR A:0x60718020
y.create.l HWIO_CRYPTO0_CRYPTO_BAM_P_TIMER_CTRL2_ADDR A:0x60719020
y.create.l HWIO_CRYPTO0_CRYPTO_BAM_P_TIMER_CTRL3_ADDR A:0x6071a020
y.create.l HWIO_CRYPTO0_CRYPTO_BAM_P_TIMER_CTRL4_ADDR A:0x6071b020
y.create.l HWIO_CRYPTO0_CRYPTO_BAM_P_TIMER_CTRL5_ADDR A:0x6071c020
y.create.l HWIO_CRYPTO0_CRYPTO_BAM_P_TIMER_CTRL6_ADDR A:0x6071d020
y.create.l HWIO_CRYPTO0_CRYPTO_BAM_P_TIMER_CTRL7_ADDR A:0x6071e020
y.create.l HWIO_CRYPTO0_CRYPTO_BAM_P_PRDCR_SDBND0_ADDR A:0x60717024
y.create.l HWIO_CRYPTO0_CRYPTO_BAM_P_PRDCR_SDBND1_ADDR A:0x60718024
y.create.l HWIO_CRYPTO0_CRYPTO_BAM_P_PRDCR_SDBND2_ADDR A:0x60719024
y.create.l HWIO_CRYPTO0_CRYPTO_BAM_P_PRDCR_SDBND3_ADDR A:0x6071a024
y.create.l HWIO_CRYPTO0_CRYPTO_BAM_P_PRDCR_SDBND4_ADDR A:0x6071b024
y.create.l HWIO_CRYPTO0_CRYPTO_BAM_P_PRDCR_SDBND5_ADDR A:0x6071c024
y.create.l HWIO_CRYPTO0_CRYPTO_BAM_P_PRDCR_SDBND6_ADDR A:0x6071d024
y.create.l HWIO_CRYPTO0_CRYPTO_BAM_P_PRDCR_SDBND7_ADDR A:0x6071e024
y.create.l HWIO_CRYPTO0_CRYPTO_BAM_P_CNSMR_SDBND0_ADDR A:0x60717028
y.create.l HWIO_CRYPTO0_CRYPTO_BAM_P_CNSMR_SDBND1_ADDR A:0x60718028
y.create.l HWIO_CRYPTO0_CRYPTO_BAM_P_CNSMR_SDBND2_ADDR A:0x60719028
y.create.l HWIO_CRYPTO0_CRYPTO_BAM_P_CNSMR_SDBND3_ADDR A:0x6071a028
y.create.l HWIO_CRYPTO0_CRYPTO_BAM_P_CNSMR_SDBND4_ADDR A:0x6071b028
y.create.l HWIO_CRYPTO0_CRYPTO_BAM_P_CNSMR_SDBND5_ADDR A:0x6071c028
y.create.l HWIO_CRYPTO0_CRYPTO_BAM_P_CNSMR_SDBND6_ADDR A:0x6071d028
y.create.l HWIO_CRYPTO0_CRYPTO_BAM_P_CNSMR_SDBND7_ADDR A:0x6071e028
y.create.l HWIO_CRYPTO0_CRYPTO_BAM_P_SW_OFSTS0_ADDR A:0x60717800
y.create.l HWIO_CRYPTO0_CRYPTO_BAM_P_SW_OFSTS1_ADDR A:0x60718800
y.create.l HWIO_CRYPTO0_CRYPTO_BAM_P_SW_OFSTS2_ADDR A:0x60719800
y.create.l HWIO_CRYPTO0_CRYPTO_BAM_P_SW_OFSTS3_ADDR A:0x6071a800
y.create.l HWIO_CRYPTO0_CRYPTO_BAM_P_SW_OFSTS4_ADDR A:0x6071b800
y.create.l HWIO_CRYPTO0_CRYPTO_BAM_P_SW_OFSTS5_ADDR A:0x6071c800
y.create.l HWIO_CRYPTO0_CRYPTO_BAM_P_SW_OFSTS6_ADDR A:0x6071d800
y.create.l HWIO_CRYPTO0_CRYPTO_BAM_P_SW_OFSTS7_ADDR A:0x6071e800
y.create.l HWIO_CRYPTO0_CRYPTO_BAM_P_AU_PSM_CNTXT_1_0_ADDR A:0x60717804
y.create.l HWIO_CRYPTO0_CRYPTO_BAM_P_AU_PSM_CNTXT_1_1_ADDR A:0x60718804
y.create.l HWIO_CRYPTO0_CRYPTO_BAM_P_AU_PSM_CNTXT_1_2_ADDR A:0x60719804
y.create.l HWIO_CRYPTO0_CRYPTO_BAM_P_AU_PSM_CNTXT_1_3_ADDR A:0x6071a804
y.create.l HWIO_CRYPTO0_CRYPTO_BAM_P_AU_PSM_CNTXT_1_4_ADDR A:0x6071b804
y.create.l HWIO_CRYPTO0_CRYPTO_BAM_P_AU_PSM_CNTXT_1_5_ADDR A:0x6071c804
y.create.l HWIO_CRYPTO0_CRYPTO_BAM_P_AU_PSM_CNTXT_1_6_ADDR A:0x6071d804
y.create.l HWIO_CRYPTO0_CRYPTO_BAM_P_AU_PSM_CNTXT_1_7_ADDR A:0x6071e804
y.create.l HWIO_CRYPTO0_CRYPTO_BAM_P_PSM_CNTXT_2_0_ADDR A:0x60717808
y.create.l HWIO_CRYPTO0_CRYPTO_BAM_P_PSM_CNTXT_2_1_ADDR A:0x60718808
y.create.l HWIO_CRYPTO0_CRYPTO_BAM_P_PSM_CNTXT_2_2_ADDR A:0x60719808
y.create.l HWIO_CRYPTO0_CRYPTO_BAM_P_PSM_CNTXT_2_3_ADDR A:0x6071a808
y.create.l HWIO_CRYPTO0_CRYPTO_BAM_P_PSM_CNTXT_2_4_ADDR A:0x6071b808
y.create.l HWIO_CRYPTO0_CRYPTO_BAM_P_PSM_CNTXT_2_5_ADDR A:0x6071c808
y.create.l HWIO_CRYPTO0_CRYPTO_BAM_P_PSM_CNTXT_2_6_ADDR A:0x6071d808
y.create.l HWIO_CRYPTO0_CRYPTO_BAM_P_PSM_CNTXT_2_7_ADDR A:0x6071e808
y.create.l HWIO_CRYPTO0_CRYPTO_BAM_P_PSM_CNTXT_3_0_ADDR A:0x6071780c
y.create.l HWIO_CRYPTO0_CRYPTO_BAM_P_PSM_CNTXT_3_1_ADDR A:0x6071880c
y.create.l HWIO_CRYPTO0_CRYPTO_BAM_P_PSM_CNTXT_3_2_ADDR A:0x6071980c
y.create.l HWIO_CRYPTO0_CRYPTO_BAM_P_PSM_CNTXT_3_3_ADDR A:0x6071a80c
y.create.l HWIO_CRYPTO0_CRYPTO_BAM_P_PSM_CNTXT_3_4_ADDR A:0x6071b80c
y.create.l HWIO_CRYPTO0_CRYPTO_BAM_P_PSM_CNTXT_3_5_ADDR A:0x6071c80c
y.create.l HWIO_CRYPTO0_CRYPTO_BAM_P_PSM_CNTXT_3_6_ADDR A:0x6071d80c
y.create.l HWIO_CRYPTO0_CRYPTO_BAM_P_PSM_CNTXT_3_7_ADDR A:0x6071e80c
y.create.l HWIO_CRYPTO0_CRYPTO_BAM_P_PSM_CNTXT_4_0_ADDR A:0x60717810
y.create.l HWIO_CRYPTO0_CRYPTO_BAM_P_PSM_CNTXT_4_1_ADDR A:0x60718810
y.create.l HWIO_CRYPTO0_CRYPTO_BAM_P_PSM_CNTXT_4_2_ADDR A:0x60719810
y.create.l HWIO_CRYPTO0_CRYPTO_BAM_P_PSM_CNTXT_4_3_ADDR A:0x6071a810
y.create.l HWIO_CRYPTO0_CRYPTO_BAM_P_PSM_CNTXT_4_4_ADDR A:0x6071b810
y.create.l HWIO_CRYPTO0_CRYPTO_BAM_P_PSM_CNTXT_4_5_ADDR A:0x6071c810
y.create.l HWIO_CRYPTO0_CRYPTO_BAM_P_PSM_CNTXT_4_6_ADDR A:0x6071d810
y.create.l HWIO_CRYPTO0_CRYPTO_BAM_P_PSM_CNTXT_4_7_ADDR A:0x6071e810
y.create.l HWIO_CRYPTO0_CRYPTO_BAM_P_PSM_CNTXT_5_0_ADDR A:0x60717814
y.create.l HWIO_CRYPTO0_CRYPTO_BAM_P_PSM_CNTXT_5_1_ADDR A:0x60718814
y.create.l HWIO_CRYPTO0_CRYPTO_BAM_P_PSM_CNTXT_5_2_ADDR A:0x60719814
y.create.l HWIO_CRYPTO0_CRYPTO_BAM_P_PSM_CNTXT_5_3_ADDR A:0x6071a814
y.create.l HWIO_CRYPTO0_CRYPTO_BAM_P_PSM_CNTXT_5_4_ADDR A:0x6071b814
y.create.l HWIO_CRYPTO0_CRYPTO_BAM_P_PSM_CNTXT_5_5_ADDR A:0x6071c814
y.create.l HWIO_CRYPTO0_CRYPTO_BAM_P_PSM_CNTXT_5_6_ADDR A:0x6071d814
y.create.l HWIO_CRYPTO0_CRYPTO_BAM_P_PSM_CNTXT_5_7_ADDR A:0x6071e814
y.create.l HWIO_CRYPTO0_CRYPTO_BAM_P_EVNT_REG0_ADDR A:0x60717818
y.create.l HWIO_CRYPTO0_CRYPTO_BAM_P_EVNT_REG1_ADDR A:0x60718818
y.create.l HWIO_CRYPTO0_CRYPTO_BAM_P_EVNT_REG2_ADDR A:0x60719818
y.create.l HWIO_CRYPTO0_CRYPTO_BAM_P_EVNT_REG3_ADDR A:0x6071a818
y.create.l HWIO_CRYPTO0_CRYPTO_BAM_P_EVNT_REG4_ADDR A:0x6071b818
y.create.l HWIO_CRYPTO0_CRYPTO_BAM_P_EVNT_REG5_ADDR A:0x6071c818
y.create.l HWIO_CRYPTO0_CRYPTO_BAM_P_EVNT_REG6_ADDR A:0x6071d818
y.create.l HWIO_CRYPTO0_CRYPTO_BAM_P_EVNT_REG7_ADDR A:0x6071e818
y.create.l HWIO_CRYPTO0_CRYPTO_BAM_P_DESC_FIFO_ADDR0_ADDR A:0x6071781c
y.create.l HWIO_CRYPTO0_CRYPTO_BAM_P_DESC_FIFO_ADDR1_ADDR A:0x6071881c
y.create.l HWIO_CRYPTO0_CRYPTO_BAM_P_DESC_FIFO_ADDR2_ADDR A:0x6071981c
y.create.l HWIO_CRYPTO0_CRYPTO_BAM_P_DESC_FIFO_ADDR3_ADDR A:0x6071a81c
y.create.l HWIO_CRYPTO0_CRYPTO_BAM_P_DESC_FIFO_ADDR4_ADDR A:0x6071b81c
y.create.l HWIO_CRYPTO0_CRYPTO_BAM_P_DESC_FIFO_ADDR5_ADDR A:0x6071c81c
y.create.l HWIO_CRYPTO0_CRYPTO_BAM_P_DESC_FIFO_ADDR6_ADDR A:0x6071d81c
y.create.l HWIO_CRYPTO0_CRYPTO_BAM_P_DESC_FIFO_ADDR7_ADDR A:0x6071e81c
y.create.l HWIO_CRYPTO0_CRYPTO_BAM_P_FIFO_SIZES0_ADDR A:0x60717820
y.create.l HWIO_CRYPTO0_CRYPTO_BAM_P_FIFO_SIZES1_ADDR A:0x60718820
y.create.l HWIO_CRYPTO0_CRYPTO_BAM_P_FIFO_SIZES2_ADDR A:0x60719820
y.create.l HWIO_CRYPTO0_CRYPTO_BAM_P_FIFO_SIZES3_ADDR A:0x6071a820
y.create.l HWIO_CRYPTO0_CRYPTO_BAM_P_FIFO_SIZES4_ADDR A:0x6071b820
y.create.l HWIO_CRYPTO0_CRYPTO_BAM_P_FIFO_SIZES5_ADDR A:0x6071c820
y.create.l HWIO_CRYPTO0_CRYPTO_BAM_P_FIFO_SIZES6_ADDR A:0x6071d820
y.create.l HWIO_CRYPTO0_CRYPTO_BAM_P_FIFO_SIZES7_ADDR A:0x6071e820
y.create.l HWIO_CRYPTO0_CRYPTO_BAM_P_DATA_FIFO_ADDR0_ADDR A:0x60717824
y.create.l HWIO_CRYPTO0_CRYPTO_BAM_P_DATA_FIFO_ADDR1_ADDR A:0x60718824
y.create.l HWIO_CRYPTO0_CRYPTO_BAM_P_DATA_FIFO_ADDR2_ADDR A:0x60719824
y.create.l HWIO_CRYPTO0_CRYPTO_BAM_P_DATA_FIFO_ADDR3_ADDR A:0x6071a824
y.create.l HWIO_CRYPTO0_CRYPTO_BAM_P_DATA_FIFO_ADDR4_ADDR A:0x6071b824
y.create.l HWIO_CRYPTO0_CRYPTO_BAM_P_DATA_FIFO_ADDR5_ADDR A:0x6071c824
y.create.l HWIO_CRYPTO0_CRYPTO_BAM_P_DATA_FIFO_ADDR6_ADDR A:0x6071d824
y.create.l HWIO_CRYPTO0_CRYPTO_BAM_P_DATA_FIFO_ADDR7_ADDR A:0x6071e824
y.create.l HWIO_CRYPTO0_CRYPTO_BAM_P_EVNT_GEN_TRSHLD0_ADDR A:0x60717828
y.create.l HWIO_CRYPTO0_CRYPTO_BAM_P_EVNT_GEN_TRSHLD1_ADDR A:0x60718828
y.create.l HWIO_CRYPTO0_CRYPTO_BAM_P_EVNT_GEN_TRSHLD2_ADDR A:0x60719828
y.create.l HWIO_CRYPTO0_CRYPTO_BAM_P_EVNT_GEN_TRSHLD3_ADDR A:0x6071a828
y.create.l HWIO_CRYPTO0_CRYPTO_BAM_P_EVNT_GEN_TRSHLD4_ADDR A:0x6071b828
y.create.l HWIO_CRYPTO0_CRYPTO_BAM_P_EVNT_GEN_TRSHLD5_ADDR A:0x6071c828
y.create.l HWIO_CRYPTO0_CRYPTO_BAM_P_EVNT_GEN_TRSHLD6_ADDR A:0x6071d828
y.create.l HWIO_CRYPTO0_CRYPTO_BAM_P_EVNT_GEN_TRSHLD7_ADDR A:0x6071e828
y.create.l HWIO_CRYPTO0_CRYPTO_BAM_P_EVNT_DEST_ADDR0_ADDR A:0x6071782c
y.create.l HWIO_CRYPTO0_CRYPTO_BAM_P_EVNT_DEST_ADDR1_ADDR A:0x6071882c
y.create.l HWIO_CRYPTO0_CRYPTO_BAM_P_EVNT_DEST_ADDR2_ADDR A:0x6071982c
y.create.l HWIO_CRYPTO0_CRYPTO_BAM_P_EVNT_DEST_ADDR3_ADDR A:0x6071a82c
y.create.l HWIO_CRYPTO0_CRYPTO_BAM_P_EVNT_DEST_ADDR4_ADDR A:0x6071b82c
y.create.l HWIO_CRYPTO0_CRYPTO_BAM_P_EVNT_DEST_ADDR5_ADDR A:0x6071c82c
y.create.l HWIO_CRYPTO0_CRYPTO_BAM_P_EVNT_DEST_ADDR6_ADDR A:0x6071d82c
y.create.l HWIO_CRYPTO0_CRYPTO_BAM_P_EVNT_DEST_ADDR7_ADDR A:0x6071e82c
y.create.l HWIO_CRYPTO0_CRYPTO_BAM_P_DF_CNTXT_0_ADDR A:0x60717830
y.create.l HWIO_CRYPTO0_CRYPTO_BAM_P_DF_CNTXT_1_ADDR A:0x60718830
y.create.l HWIO_CRYPTO0_CRYPTO_BAM_P_DF_CNTXT_2_ADDR A:0x60719830
y.create.l HWIO_CRYPTO0_CRYPTO_BAM_P_DF_CNTXT_3_ADDR A:0x6071a830
y.create.l HWIO_CRYPTO0_CRYPTO_BAM_P_DF_CNTXT_4_ADDR A:0x6071b830
y.create.l HWIO_CRYPTO0_CRYPTO_BAM_P_DF_CNTXT_5_ADDR A:0x6071c830
y.create.l HWIO_CRYPTO0_CRYPTO_BAM_P_DF_CNTXT_6_ADDR A:0x6071d830
y.create.l HWIO_CRYPTO0_CRYPTO_BAM_P_DF_CNTXT_7_ADDR A:0x6071e830
y.create.l HWIO_CRYPTO0_CRYPTO_BAM_P_RETR_CNTXT_0_ADDR A:0x60717834
y.create.l HWIO_CRYPTO0_CRYPTO_BAM_P_RETR_CNTXT_1_ADDR A:0x60718834
y.create.l HWIO_CRYPTO0_CRYPTO_BAM_P_RETR_CNTXT_2_ADDR A:0x60719834
y.create.l HWIO_CRYPTO0_CRYPTO_BAM_P_RETR_CNTXT_3_ADDR A:0x6071a834
y.create.l HWIO_CRYPTO0_CRYPTO_BAM_P_RETR_CNTXT_4_ADDR A:0x6071b834
y.create.l HWIO_CRYPTO0_CRYPTO_BAM_P_RETR_CNTXT_5_ADDR A:0x6071c834
y.create.l HWIO_CRYPTO0_CRYPTO_BAM_P_RETR_CNTXT_6_ADDR A:0x6071d834
y.create.l HWIO_CRYPTO0_CRYPTO_BAM_P_RETR_CNTXT_7_ADDR A:0x6071e834
y.create.l HWIO_CRYPTO0_CRYPTO_BAM_P_SI_CNTXT_0_ADDR A:0x60717838
y.create.l HWIO_CRYPTO0_CRYPTO_BAM_P_SI_CNTXT_1_ADDR A:0x60718838
y.create.l HWIO_CRYPTO0_CRYPTO_BAM_P_SI_CNTXT_2_ADDR A:0x60719838
y.create.l HWIO_CRYPTO0_CRYPTO_BAM_P_SI_CNTXT_3_ADDR A:0x6071a838
y.create.l HWIO_CRYPTO0_CRYPTO_BAM_P_SI_CNTXT_4_ADDR A:0x6071b838
y.create.l HWIO_CRYPTO0_CRYPTO_BAM_P_SI_CNTXT_5_ADDR A:0x6071c838
y.create.l HWIO_CRYPTO0_CRYPTO_BAM_P_SI_CNTXT_6_ADDR A:0x6071d838
y.create.l HWIO_CRYPTO0_CRYPTO_BAM_P_SI_CNTXT_7_ADDR A:0x6071e838
y.create.l HWIO_CRYPTO0_CRYPTO_BAM_P_PSM_CNTXT_3_LSB0_ADDR A:0x60717900
y.create.l HWIO_CRYPTO0_CRYPTO_BAM_P_PSM_CNTXT_3_LSB1_ADDR A:0x60718900
y.create.l HWIO_CRYPTO0_CRYPTO_BAM_P_PSM_CNTXT_3_LSB2_ADDR A:0x60719900
y.create.l HWIO_CRYPTO0_CRYPTO_BAM_P_PSM_CNTXT_3_LSB3_ADDR A:0x6071a900
y.create.l HWIO_CRYPTO0_CRYPTO_BAM_P_PSM_CNTXT_3_LSB4_ADDR A:0x6071b900
y.create.l HWIO_CRYPTO0_CRYPTO_BAM_P_PSM_CNTXT_3_LSB5_ADDR A:0x6071c900
y.create.l HWIO_CRYPTO0_CRYPTO_BAM_P_PSM_CNTXT_3_LSB6_ADDR A:0x6071d900
y.create.l HWIO_CRYPTO0_CRYPTO_BAM_P_PSM_CNTXT_3_LSB7_ADDR A:0x6071e900
y.create.l HWIO_CRYPTO0_CRYPTO_BAM_P_PSM_CNTXT_3_MSB0_ADDR A:0x60717904
y.create.l HWIO_CRYPTO0_CRYPTO_BAM_P_PSM_CNTXT_3_MSB1_ADDR A:0x60718904
y.create.l HWIO_CRYPTO0_CRYPTO_BAM_P_PSM_CNTXT_3_MSB2_ADDR A:0x60719904
y.create.l HWIO_CRYPTO0_CRYPTO_BAM_P_PSM_CNTXT_3_MSB3_ADDR A:0x6071a904
y.create.l HWIO_CRYPTO0_CRYPTO_BAM_P_PSM_CNTXT_3_MSB4_ADDR A:0x6071b904
y.create.l HWIO_CRYPTO0_CRYPTO_BAM_P_PSM_CNTXT_3_MSB5_ADDR A:0x6071c904
y.create.l HWIO_CRYPTO0_CRYPTO_BAM_P_PSM_CNTXT_3_MSB6_ADDR A:0x6071d904
y.create.l HWIO_CRYPTO0_CRYPTO_BAM_P_PSM_CNTXT_3_MSB7_ADDR A:0x6071e904
y.create.l HWIO_CRYPTO0_CRYPTO_BAM_P_DESC_FIFO_ADDR_LSB0_ADDR A:0x60717910
y.create.l HWIO_CRYPTO0_CRYPTO_BAM_P_DESC_FIFO_ADDR_LSB1_ADDR A:0x60718910
y.create.l HWIO_CRYPTO0_CRYPTO_BAM_P_DESC_FIFO_ADDR_LSB2_ADDR A:0x60719910
y.create.l HWIO_CRYPTO0_CRYPTO_BAM_P_DESC_FIFO_ADDR_LSB3_ADDR A:0x6071a910
y.create.l HWIO_CRYPTO0_CRYPTO_BAM_P_DESC_FIFO_ADDR_LSB4_ADDR A:0x6071b910
y.create.l HWIO_CRYPTO0_CRYPTO_BAM_P_DESC_FIFO_ADDR_LSB5_ADDR A:0x6071c910
y.create.l HWIO_CRYPTO0_CRYPTO_BAM_P_DESC_FIFO_ADDR_LSB6_ADDR A:0x6071d910
y.create.l HWIO_CRYPTO0_CRYPTO_BAM_P_DESC_FIFO_ADDR_LSB7_ADDR A:0x6071e910
y.create.l HWIO_CRYPTO0_CRYPTO_BAM_P_DESC_FIFO_ADDR_MSB0_ADDR A:0x60717914
y.create.l HWIO_CRYPTO0_CRYPTO_BAM_P_DESC_FIFO_ADDR_MSB1_ADDR A:0x60718914
y.create.l HWIO_CRYPTO0_CRYPTO_BAM_P_DESC_FIFO_ADDR_MSB2_ADDR A:0x60719914
y.create.l HWIO_CRYPTO0_CRYPTO_BAM_P_DESC_FIFO_ADDR_MSB3_ADDR A:0x6071a914
y.create.l HWIO_CRYPTO0_CRYPTO_BAM_P_DESC_FIFO_ADDR_MSB4_ADDR A:0x6071b914
y.create.l HWIO_CRYPTO0_CRYPTO_BAM_P_DESC_FIFO_ADDR_MSB5_ADDR A:0x6071c914
y.create.l HWIO_CRYPTO0_CRYPTO_BAM_P_DESC_FIFO_ADDR_MSB6_ADDR A:0x6071d914
y.create.l HWIO_CRYPTO0_CRYPTO_BAM_P_DESC_FIFO_ADDR_MSB7_ADDR A:0x6071e914
y.create.l HWIO_CRYPTO0_CRYPTO_BAM_P_DATA_FIFO_ADDR_LSB0_ADDR A:0x60717920
y.create.l HWIO_CRYPTO0_CRYPTO_BAM_P_DATA_FIFO_ADDR_LSB1_ADDR A:0x60718920
y.create.l HWIO_CRYPTO0_CRYPTO_BAM_P_DATA_FIFO_ADDR_LSB2_ADDR A:0x60719920
y.create.l HWIO_CRYPTO0_CRYPTO_BAM_P_DATA_FIFO_ADDR_LSB3_ADDR A:0x6071a920
y.create.l HWIO_CRYPTO0_CRYPTO_BAM_P_DATA_FIFO_ADDR_LSB4_ADDR A:0x6071b920
y.create.l HWIO_CRYPTO0_CRYPTO_BAM_P_DATA_FIFO_ADDR_LSB5_ADDR A:0x6071c920
y.create.l HWIO_CRYPTO0_CRYPTO_BAM_P_DATA_FIFO_ADDR_LSB6_ADDR A:0x6071d920
y.create.l HWIO_CRYPTO0_CRYPTO_BAM_P_DATA_FIFO_ADDR_LSB7_ADDR A:0x6071e920
y.create.l HWIO_CRYPTO0_CRYPTO_BAM_P_DATA_FIFO_ADDR_MSB0_ADDR A:0x60717924
y.create.l HWIO_CRYPTO0_CRYPTO_BAM_P_DATA_FIFO_ADDR_MSB1_ADDR A:0x60718924
y.create.l HWIO_CRYPTO0_CRYPTO_BAM_P_DATA_FIFO_ADDR_MSB2_ADDR A:0x60719924
y.create.l HWIO_CRYPTO0_CRYPTO_BAM_P_DATA_FIFO_ADDR_MSB3_ADDR A:0x6071a924
y.create.l HWIO_CRYPTO0_CRYPTO_BAM_P_DATA_FIFO_ADDR_MSB4_ADDR A:0x6071b924
y.create.l HWIO_CRYPTO0_CRYPTO_BAM_P_DATA_FIFO_ADDR_MSB5_ADDR A:0x6071c924
y.create.l HWIO_CRYPTO0_CRYPTO_BAM_P_DATA_FIFO_ADDR_MSB6_ADDR A:0x6071d924
y.create.l HWIO_CRYPTO0_CRYPTO_BAM_P_DATA_FIFO_ADDR_MSB7_ADDR A:0x6071e924
y.create.l HWIO_CRYPTO0_CRYPTO_BAM_P_EVNT_DEST_ADDR_LSB0_ADDR A:0x60717930
y.create.l HWIO_CRYPTO0_CRYPTO_BAM_P_EVNT_DEST_ADDR_LSB1_ADDR A:0x60718930
y.create.l HWIO_CRYPTO0_CRYPTO_BAM_P_EVNT_DEST_ADDR_LSB2_ADDR A:0x60719930
y.create.l HWIO_CRYPTO0_CRYPTO_BAM_P_EVNT_DEST_ADDR_LSB3_ADDR A:0x6071a930
y.create.l HWIO_CRYPTO0_CRYPTO_BAM_P_EVNT_DEST_ADDR_LSB4_ADDR A:0x6071b930
y.create.l HWIO_CRYPTO0_CRYPTO_BAM_P_EVNT_DEST_ADDR_LSB5_ADDR A:0x6071c930
y.create.l HWIO_CRYPTO0_CRYPTO_BAM_P_EVNT_DEST_ADDR_LSB6_ADDR A:0x6071d930
y.create.l HWIO_CRYPTO0_CRYPTO_BAM_P_EVNT_DEST_ADDR_LSB7_ADDR A:0x6071e930
y.create.l HWIO_CRYPTO0_CRYPTO_BAM_P_EVNT_DEST_ADDR_MSB0_ADDR A:0x60717934
y.create.l HWIO_CRYPTO0_CRYPTO_BAM_P_EVNT_DEST_ADDR_MSB1_ADDR A:0x60718934
y.create.l HWIO_CRYPTO0_CRYPTO_BAM_P_EVNT_DEST_ADDR_MSB2_ADDR A:0x60719934
y.create.l HWIO_CRYPTO0_CRYPTO_BAM_P_EVNT_DEST_ADDR_MSB3_ADDR A:0x6071a934
y.create.l HWIO_CRYPTO0_CRYPTO_BAM_P_EVNT_DEST_ADDR_MSB4_ADDR A:0x6071b934
y.create.l HWIO_CRYPTO0_CRYPTO_BAM_P_EVNT_DEST_ADDR_MSB5_ADDR A:0x6071c934
y.create.l HWIO_CRYPTO0_CRYPTO_BAM_P_EVNT_DEST_ADDR_MSB6_ADDR A:0x6071d934
y.create.l HWIO_CRYPTO0_CRYPTO_BAM_P_EVNT_DEST_ADDR_MSB7_ADDR A:0x6071e934
y.create.l HWIO_CRYPTO0_CRYPTO_BAM_XPU_SCR_ADDR A:0x60702000
y.create.l HWIO_CRYPTO0_CRYPTO_BAM_XPU_SWDR_ADDR A:0x60702004
y.create.l HWIO_CRYPTO0_CRYPTO_BAM_XPU_SEAR0_ADDR A:0x60702040
y.create.l HWIO_CRYPTO0_CRYPTO_BAM_XPU_SESR_ADDR A:0x60702048
y.create.l HWIO_CRYPTO0_CRYPTO_BAM_XPU_SESRRESTORE_ADDR A:0x6070204c
y.create.l HWIO_CRYPTO0_CRYPTO_BAM_XPU_SESYNR0_ADDR A:0x60702050
y.create.l HWIO_CRYPTO0_CRYPTO_BAM_XPU_SESYNR1_ADDR A:0x60702054
y.create.l HWIO_CRYPTO0_CRYPTO_BAM_XPU_SESYNR2_ADDR A:0x60702058
y.create.l HWIO_CRYPTO0_CRYPTO_BAM_XPU_MCR_ADDR A:0x60702100
y.create.l HWIO_CRYPTO0_CRYPTO_BAM_XPU_MEAR0_ADDR A:0x60702140
y.create.l HWIO_CRYPTO0_CRYPTO_BAM_XPU_MESR_ADDR A:0x60702148
y.create.l HWIO_CRYPTO0_CRYPTO_BAM_XPU_MESRRESTORE_ADDR A:0x6070214c
y.create.l HWIO_CRYPTO0_CRYPTO_BAM_XPU_MESYNR0_ADDR A:0x60702150
y.create.l HWIO_CRYPTO0_CRYPTO_BAM_XPU_MESYNR1_ADDR A:0x60702154
y.create.l HWIO_CRYPTO0_CRYPTO_BAM_XPU_MESYNR2_ADDR A:0x60702158
y.create.l HWIO_CRYPTO0_CRYPTO_BAM_XPU_CR_ADDR A:0x60702080
y.create.l HWIO_CRYPTO0_CRYPTO_BAM_XPU_RPU_ACR0_ADDR A:0x607020a0
y.create.l HWIO_CRYPTO0_CRYPTO_BAM_XPU_EAR0_ADDR A:0x607020c0
y.create.l HWIO_CRYPTO0_CRYPTO_BAM_XPU_ESR_ADDR A:0x607020c8
y.create.l HWIO_CRYPTO0_CRYPTO_BAM_XPU_ESRRESTORE_ADDR A:0x607020cc
y.create.l HWIO_CRYPTO0_CRYPTO_BAM_XPU_ESYNR0_ADDR A:0x607020d0
y.create.l HWIO_CRYPTO0_CRYPTO_BAM_XPU_ESYNR1_ADDR A:0x607020d4
y.create.l HWIO_CRYPTO0_CRYPTO_BAM_XPU_ESYNR2_ADDR A:0x607020d8
y.create.l HWIO_CRYPTO0_CRYPTO_BAM_XPU_IDR0_ADDR A:0x60702074
y.create.l HWIO_CRYPTO0_CRYPTO_BAM_XPU_IDR1_ADDR A:0x60702078
y.create.l HWIO_CRYPTO0_CRYPTO_BAM_XPU_REV_ADDR A:0x6070207c
y.create.l HWIO_CRYPTO0_CRYPTO_BAM_XPU_RG0_RACR0_ADDR A:0x60702200
y.create.l HWIO_CRYPTO0_CRYPTO_BAM_XPU_RG1_RACR0_ADDR A:0x60702280
y.create.l HWIO_CRYPTO0_CRYPTO_BAM_XPU_RG2_RACR0_ADDR A:0x60702300
y.create.l HWIO_CRYPTO0_CRYPTO_BAM_XPU_RG3_RACR0_ADDR A:0x60702380
y.create.l HWIO_CRYPTO0_CRYPTO_BAM_XPU_RG4_RACR0_ADDR A:0x60702400
y.create.l HWIO_CRYPTO0_CRYPTO_BAM_XPU_RG5_RACR0_ADDR A:0x60702480
y.create.l HWIO_CRYPTO0_CRYPTO_BAM_XPU_RG6_RACR0_ADDR A:0x60702500
y.create.l HWIO_CRYPTO0_CRYPTO_BAM_XPU_RG7_RACR0_ADDR A:0x60702580
y.create.l HWIO_CRYPTO0_CRYPTO_BAM_XPU_RG8_RACR0_ADDR A:0x60702600
y.create.l HWIO_CRYPTO0_CRYPTO_BAM_XPU_RG9_RACR0_ADDR A:0x60702680
y.create.l HWIO_CRYPTO0_CRYPTO_BAM_XPU_RG0_SCR_ADDR A:0x60702250
y.create.l HWIO_CRYPTO0_CRYPTO_BAM_XPU_RG1_SCR_ADDR A:0x607022d0
y.create.l HWIO_CRYPTO0_CRYPTO_BAM_XPU_RG2_SCR_ADDR A:0x60702350
y.create.l HWIO_CRYPTO0_CRYPTO_BAM_XPU_RG3_SCR_ADDR A:0x607023d0
y.create.l HWIO_CRYPTO0_CRYPTO_BAM_XPU_RG4_SCR_ADDR A:0x60702450
y.create.l HWIO_CRYPTO0_CRYPTO_BAM_XPU_RG5_SCR_ADDR A:0x607024d0
y.create.l HWIO_CRYPTO0_CRYPTO_BAM_XPU_RG6_SCR_ADDR A:0x60702550
y.create.l HWIO_CRYPTO0_CRYPTO_BAM_XPU_RG7_SCR_ADDR A:0x607025d0
y.create.l HWIO_CRYPTO0_CRYPTO_BAM_XPU_RG8_SCR_ADDR A:0x60702650
y.create.l HWIO_CRYPTO0_CRYPTO_BAM_XPU_RG9_SCR_ADDR A:0x607026d0
y.create.l HWIO_CRYPTO0_CRYPTO_BAM_XPU_RG0_MCR_ADDR A:0x60702254
y.create.l HWIO_CRYPTO0_CRYPTO_BAM_XPU_RG1_MCR_ADDR A:0x607022d4
y.create.l HWIO_CRYPTO0_CRYPTO_BAM_XPU_RG2_MCR_ADDR A:0x60702354
y.create.l HWIO_CRYPTO0_CRYPTO_BAM_XPU_RG3_MCR_ADDR A:0x607023d4
y.create.l HWIO_CRYPTO0_CRYPTO_BAM_XPU_RG4_MCR_ADDR A:0x60702454
y.create.l HWIO_CRYPTO0_CRYPTO_BAM_XPU_RG5_MCR_ADDR A:0x607024d4
y.create.l HWIO_CRYPTO0_CRYPTO_BAM_XPU_RG6_MCR_ADDR A:0x60702554
y.create.l HWIO_CRYPTO0_CRYPTO_BAM_XPU_RG7_MCR_ADDR A:0x607025d4
y.create.l HWIO_CRYPTO0_CRYPTO_BAM_XPU_RG8_MCR_ADDR A:0x60702654
y.create.l HWIO_CRYPTO0_CRYPTO_BAM_XPU_RG9_MCR_ADDR A:0x607026d4
y.create.l HWIO_CRYPTO0_CRYPTO_BAM_VMIDMT_SCR0_ADDR A:0x60700000
y.create.l HWIO_CRYPTO0_CRYPTO_BAM_VMIDMT_SCR1_ADDR A:0x60700004
y.create.l HWIO_CRYPTO0_CRYPTO_BAM_VMIDMT_SCR2_ADDR A:0x60700008
y.create.l HWIO_CRYPTO0_CRYPTO_BAM_VMIDMT_SACR_ADDR A:0x60700010
y.create.l HWIO_CRYPTO0_CRYPTO_BAM_VMIDMT_SIDR0_ADDR A:0x60700020
y.create.l HWIO_CRYPTO0_CRYPTO_BAM_VMIDMT_SIDR1_ADDR A:0x60700024
y.create.l HWIO_CRYPTO0_CRYPTO_BAM_VMIDMT_SIDR2_ADDR A:0x60700028
y.create.l HWIO_CRYPTO0_CRYPTO_BAM_VMIDMT_SIDR4_ADDR A:0x60700030
y.create.l HWIO_CRYPTO0_CRYPTO_BAM_VMIDMT_SIDR5_ADDR A:0x60700034
y.create.l HWIO_CRYPTO0_CRYPTO_BAM_VMIDMT_SIDR7_ADDR A:0x6070003c
y.create.l HWIO_CRYPTO0_CRYPTO_BAM_VMIDMT_SGFAR0_ADDR A:0x60700040
y.create.l HWIO_CRYPTO0_CRYPTO_BAM_VMIDMT_SGFSR_ADDR A:0x60700048
y.create.l HWIO_CRYPTO0_CRYPTO_BAM_VMIDMT_SGFSRRESTORE_ADDR A:0x6070004c
y.create.l HWIO_CRYPTO0_CRYPTO_BAM_VMIDMT_SGFSYNDR0_ADDR A:0x60700050
y.create.l HWIO_CRYPTO0_CRYPTO_BAM_VMIDMT_SGFSYNDR1_ADDR A:0x60700054
y.create.l HWIO_CRYPTO0_CRYPTO_BAM_VMIDMT_SGFSYNDR2_ADDR A:0x60700058
y.create.l HWIO_CRYPTO0_CRYPTO_BAM_VMIDMT_VMIDMTSCR0_ADDR A:0x60700090
y.create.l HWIO_CRYPTO0_CRYPTO_BAM_VMIDMT_CR0_ADDR A:0x60700000
y.create.l HWIO_CRYPTO0_CRYPTO_BAM_VMIDMT_CR2_ADDR A:0x60700008
y.create.l HWIO_CRYPTO0_CRYPTO_BAM_VMIDMT_ACR_ADDR A:0x60700010
y.create.l HWIO_CRYPTO0_CRYPTO_BAM_VMIDMT_IDR0_ADDR A:0x60700020
y.create.l HWIO_CRYPTO0_CRYPTO_BAM_VMIDMT_IDR1_ADDR A:0x60700024
y.create.l HWIO_CRYPTO0_CRYPTO_BAM_VMIDMT_IDR2_ADDR A:0x60700028
y.create.l HWIO_CRYPTO0_CRYPTO_BAM_VMIDMT_IDR4_ADDR A:0x60700030
y.create.l HWIO_CRYPTO0_CRYPTO_BAM_VMIDMT_IDR5_ADDR A:0x60700034
y.create.l HWIO_CRYPTO0_CRYPTO_BAM_VMIDMT_IDR7_ADDR A:0x6070003c
y.create.l HWIO_CRYPTO0_CRYPTO_BAM_VMIDMT_GFAR0_ADDR A:0x60700040
y.create.l HWIO_CRYPTO0_CRYPTO_BAM_VMIDMT_GFSR_ADDR A:0x60700048
y.create.l HWIO_CRYPTO0_CRYPTO_BAM_VMIDMT_GFSRRESTORE_ADDR A:0x6070004c
y.create.l HWIO_CRYPTO0_CRYPTO_BAM_VMIDMT_GFSYNDR0_ADDR A:0x60700050
y.create.l HWIO_CRYPTO0_CRYPTO_BAM_VMIDMT_GFSYNDR1_ADDR A:0x60700054
y.create.l HWIO_CRYPTO0_CRYPTO_BAM_VMIDMT_GFSYNDR2_ADDR A:0x60700058
y.create.l HWIO_CRYPTO0_CRYPTO_BAM_VMIDMT_VMIDMTCR0_ADDR A:0x60700090
y.create.l HWIO_CRYPTO0_CRYPTO_BAM_VMIDMT_VMIDMTACR_ADDR A:0x6070009c
y.create.l HWIO_CRYPTO0_CRYPTO_BAM_VMIDMT_NSCR0_ADDR A:0x60700400
y.create.l HWIO_CRYPTO0_CRYPTO_BAM_VMIDMT_NSCR2_ADDR A:0x60700408
y.create.l HWIO_CRYPTO0_CRYPTO_BAM_VMIDMT_NSACR_ADDR A:0x60700410
y.create.l HWIO_CRYPTO0_CRYPTO_BAM_VMIDMT_NSGFAR0_ADDR A:0x60700440
y.create.l HWIO_CRYPTO0_CRYPTO_BAM_VMIDMT_NSGFSR_ADDR A:0x60700448
y.create.l HWIO_CRYPTO0_CRYPTO_BAM_VMIDMT_NSGFSRRESTORE_ADDR A:0x6070044c
y.create.l HWIO_CRYPTO0_CRYPTO_BAM_VMIDMT_NSGFSYNDR0_ADDR A:0x60700450
y.create.l HWIO_CRYPTO0_CRYPTO_BAM_VMIDMT_NSGFSYNDR1_ADDR A:0x60700454
y.create.l HWIO_CRYPTO0_CRYPTO_BAM_VMIDMT_NSGFSYNDR2_ADDR A:0x60700458
y.create.l HWIO_CRYPTO0_CRYPTO_BAM_VMIDMT_NSVMIDMTCR0_ADDR A:0x60700490
y.create.l HWIO_CRYPTO0_CRYPTO_BAM_VMIDMT_SSDR0_ADDR A:0x60700080
y.create.l HWIO_CRYPTO0_CRYPTO_BAM_VMIDMT_MSDR0_ADDR A:0x60700480
y.create.l HWIO_CRYPTO0_CRYPTO_BAM_VMIDMT_MCR_ADDR A:0x60700494
y.create.l HWIO_CRYPTO0_CRYPTO_BAM_VMIDMT_S2VR0_ADDR A:0x60700c00
y.create.l HWIO_CRYPTO0_CRYPTO_BAM_VMIDMT_S2VR1_ADDR A:0x60700c04
y.create.l HWIO_CRYPTO0_CRYPTO_BAM_VMIDMT_S2VR2_ADDR A:0x60700c08
y.create.l HWIO_CRYPTO0_CRYPTO_BAM_VMIDMT_S2VR3_ADDR A:0x60700c0c
y.create.l HWIO_CRYPTO0_CRYPTO_BAM_VMIDMT_S2VR4_ADDR A:0x60700c10
y.create.l HWIO_CRYPTO0_CRYPTO_BAM_VMIDMT_S2VR5_ADDR A:0x60700c14
y.create.l HWIO_CRYPTO0_CRYPTO_BAM_VMIDMT_S2VR6_ADDR A:0x60700c18
y.create.l HWIO_CRYPTO0_CRYPTO_BAM_VMIDMT_S2VR7_ADDR A:0x60700c1c
y.create.l HWIO_CRYPTO0_CRYPTO_BAM_VMIDMT_S2VR8_ADDR A:0x60700c20
y.create.l HWIO_CRYPTO0_CRYPTO_BAM_VMIDMT_AS2VR0_ADDR A:0x60700e00
y.create.l HWIO_CRYPTO0_CRYPTO_BAM_VMIDMT_AS2VR1_ADDR A:0x60700e04
y.create.l HWIO_CRYPTO0_CRYPTO_BAM_VMIDMT_AS2VR2_ADDR A:0x60700e08
y.create.l HWIO_CRYPTO0_CRYPTO_BAM_VMIDMT_AS2VR3_ADDR A:0x60700e0c
y.create.l HWIO_CRYPTO0_CRYPTO_BAM_VMIDMT_AS2VR4_ADDR A:0x60700e10
y.create.l HWIO_CRYPTO0_CRYPTO_BAM_VMIDMT_AS2VR5_ADDR A:0x60700e14
y.create.l HWIO_CRYPTO0_CRYPTO_BAM_VMIDMT_AS2VR6_ADDR A:0x60700e18
y.create.l HWIO_CRYPTO0_CRYPTO_BAM_VMIDMT_AS2VR7_ADDR A:0x60700e1c
y.create.l HWIO_CRYPTO0_CRYPTO_BAM_VMIDMT_AS2VR8_ADDR A:0x60700e20
y.create.l HWIO_CRYPTO0_CRYPTO_BAM_VMIDMT_SMR0_ADDR A:0x60700800
y.create.l HWIO_CRYPTO0_CRYPTO_BAM_VMIDMT_SMR1_ADDR A:0x60700804
y.create.l HWIO_CRYPTO0_CRYPTO_BAM_VMIDMT_SMR2_ADDR A:0x60700808
y.create.l HWIO_CRYPTO0_CRYPTO_BAM_VMIDMT_SMR3_ADDR A:0x6070080c
y.create.l HWIO_CRYPTO0_CRYPTO_BAM_VMIDMT_SMR4_ADDR A:0x60700810
y.create.l HWIO_CRYPTO0_CRYPTO_BAM_VMIDMT_SMR5_ADDR A:0x60700814
y.create.l HWIO_CRYPTO0_CRYPTO_BAM_VMIDMT_SMR6_ADDR A:0x60700818
y.create.l HWIO_CRYPTO0_CRYPTO_BAM_VMIDMT_SMR7_ADDR A:0x6070081c
y.create.l HWIO_CRYPTO0_CRYPTO_BAM_VMIDMT_SMR8_ADDR A:0x60700820
y.create.l HWIO_DEHR_BIMC_DEHR_HW_VERSION_ADDR A:0x604b2000
y.create.l HWIO_DEHR_BIMC_DEHR_HW_INFO_ADDR A:0x604b2004
y.create.l HWIO_DEHR_BIMC_DEHR_CGC_CFG_ADDR A:0x604b2010
y.create.l HWIO_DEHR_BIMC_DEHR_MSA_CFG_ADDR A:0x604b2104
y.create.l HWIO_DEHR_BIMC_DEHR_RAM_CFG_ADDR A:0x604b2140
y.create.l HWIO_DEHR_BIMC_DEHR_DMA_STATUS_ADDR A:0x604b2200
y.create.l HWIO_DEHR_BIMC_DEHR_DBG_CFG_ADDR A:0x604b2400
y.create.l HWIO_DEHR_BIMC_DEHR_SW_DMA_CFG_ADDR A:0x604b2404
y.create.l HWIO_DEHR_BIMC_DEHR_DBG_ADDR_ADDR A:0x604b2408
y.create.l HWIO_DEHR_BIMC_DEHR_SEC_CFG_ADDR A:0x604b3000
y.create.l HWIO_DEHR_XPU_SCR_ADDR A:0x604b0000
y.create.l HWIO_DEHR_XPU_SWDR_ADDR A:0x604b0004
y.create.l HWIO_DEHR_XPU_SEAR0_ADDR A:0x604b0040
y.create.l HWIO_DEHR_XPU_SESR_ADDR A:0x604b0048
y.create.l HWIO_DEHR_XPU_SESRRESTORE_ADDR A:0x604b004c
y.create.l HWIO_DEHR_XPU_SESYNR0_ADDR A:0x604b0050
y.create.l HWIO_DEHR_XPU_SESYNR1_ADDR A:0x604b0054
y.create.l HWIO_DEHR_XPU_SESYNR2_ADDR A:0x604b0058
y.create.l HWIO_DEHR_XPU_MCR_ADDR A:0x604b0100
y.create.l HWIO_DEHR_XPU_MEAR0_ADDR A:0x604b0140
y.create.l HWIO_DEHR_XPU_MESR_ADDR A:0x604b0148
y.create.l HWIO_DEHR_XPU_MESRRESTORE_ADDR A:0x604b014c
y.create.l HWIO_DEHR_XPU_MESYNR0_ADDR A:0x604b0150
y.create.l HWIO_DEHR_XPU_MESYNR1_ADDR A:0x604b0154
y.create.l HWIO_DEHR_XPU_MESYNR2_ADDR A:0x604b0158
y.create.l HWIO_DEHR_XPU_CR_ADDR A:0x604b0080
y.create.l HWIO_DEHR_XPU_RPU_ACR0_ADDR A:0x604b00a0
y.create.l HWIO_DEHR_XPU_EAR0_ADDR A:0x604b00c0
y.create.l HWIO_DEHR_XPU_ESR_ADDR A:0x604b00c8
y.create.l HWIO_DEHR_XPU_ESRRESTORE_ADDR A:0x604b00cc
y.create.l HWIO_DEHR_XPU_ESYNR0_ADDR A:0x604b00d0
y.create.l HWIO_DEHR_XPU_ESYNR1_ADDR A:0x604b00d4
y.create.l HWIO_DEHR_XPU_ESYNR2_ADDR A:0x604b00d8
y.create.l HWIO_DEHR_XPU_IDR0_ADDR A:0x604b0074
y.create.l HWIO_DEHR_XPU_IDR1_ADDR A:0x604b0078
y.create.l HWIO_DEHR_XPU_REV_ADDR A:0x604b007c
y.create.l HWIO_DEHR_XPU_RG0_RACR0_ADDR A:0x604b0200
y.create.l HWIO_DEHR_XPU_RG1_RACR0_ADDR A:0x604b0280
y.create.l HWIO_DEHR_XPU_RG0_SCR_ADDR A:0x604b0250
y.create.l HWIO_DEHR_XPU_RG1_SCR_ADDR A:0x604b02d0
y.create.l HWIO_DEHR_XPU_RG0_MCR_ADDR A:0x604b0254
y.create.l HWIO_DEHR_XPU_RG1_MCR_ADDR A:0x604b02d4
y.create.l HWIO_DEHR_VMIDMT_SCR0_ADDR A:0x604b1000
y.create.l HWIO_DEHR_VMIDMT_SCR1_ADDR A:0x604b1004
y.create.l HWIO_DEHR_VMIDMT_SCR2_ADDR A:0x604b1008
y.create.l HWIO_DEHR_VMIDMT_SACR_ADDR A:0x604b1010
y.create.l HWIO_DEHR_VMIDMT_SIDR0_ADDR A:0x604b1020
y.create.l HWIO_DEHR_VMIDMT_SIDR1_ADDR A:0x604b1024
y.create.l HWIO_DEHR_VMIDMT_SIDR2_ADDR A:0x604b1028
y.create.l HWIO_DEHR_VMIDMT_SIDR4_ADDR A:0x604b1030
y.create.l HWIO_DEHR_VMIDMT_SIDR5_ADDR A:0x604b1034
y.create.l HWIO_DEHR_VMIDMT_SIDR7_ADDR A:0x604b103c
y.create.l HWIO_DEHR_VMIDMT_SGFAR0_ADDR A:0x604b1040
y.create.l HWIO_DEHR_VMIDMT_SGFSR_ADDR A:0x604b1048
y.create.l HWIO_DEHR_VMIDMT_SGFSRRESTORE_ADDR A:0x604b104c
y.create.l HWIO_DEHR_VMIDMT_SGFSYNDR0_ADDR A:0x604b1050
y.create.l HWIO_DEHR_VMIDMT_SGFSYNDR1_ADDR A:0x604b1054
y.create.l HWIO_DEHR_VMIDMT_SGFSYNDR2_ADDR A:0x604b1058
y.create.l HWIO_DEHR_VMIDMT_VMIDMTSCR0_ADDR A:0x604b1090
y.create.l HWIO_DEHR_VMIDMT_CR0_ADDR A:0x604b1000
y.create.l HWIO_DEHR_VMIDMT_CR2_ADDR A:0x604b1008
y.create.l HWIO_DEHR_VMIDMT_ACR_ADDR A:0x604b1010
y.create.l HWIO_DEHR_VMIDMT_IDR0_ADDR A:0x604b1020
y.create.l HWIO_DEHR_VMIDMT_IDR1_ADDR A:0x604b1024
y.create.l HWIO_DEHR_VMIDMT_IDR2_ADDR A:0x604b1028
y.create.l HWIO_DEHR_VMIDMT_IDR4_ADDR A:0x604b1030
y.create.l HWIO_DEHR_VMIDMT_IDR5_ADDR A:0x604b1034
y.create.l HWIO_DEHR_VMIDMT_IDR7_ADDR A:0x604b103c
y.create.l HWIO_DEHR_VMIDMT_GFAR0_ADDR A:0x604b1040
y.create.l HWIO_DEHR_VMIDMT_GFSR_ADDR A:0x604b1048
y.create.l HWIO_DEHR_VMIDMT_GFSRRESTORE_ADDR A:0x604b104c
y.create.l HWIO_DEHR_VMIDMT_GFSYNDR0_ADDR A:0x604b1050
y.create.l HWIO_DEHR_VMIDMT_GFSYNDR1_ADDR A:0x604b1054
y.create.l HWIO_DEHR_VMIDMT_GFSYNDR2_ADDR A:0x604b1058
y.create.l HWIO_DEHR_VMIDMT_VMIDMTCR0_ADDR A:0x604b1090
y.create.l HWIO_DEHR_VMIDMT_VMIDMTACR_ADDR A:0x604b109c
y.create.l HWIO_DEHR_VMIDMT_NSCR0_ADDR A:0x604b1400
y.create.l HWIO_DEHR_VMIDMT_NSCR2_ADDR A:0x604b1408
y.create.l HWIO_DEHR_VMIDMT_NSACR_ADDR A:0x604b1410
y.create.l HWIO_DEHR_VMIDMT_NSGFAR0_ADDR A:0x604b1440
y.create.l HWIO_DEHR_VMIDMT_NSGFSR_ADDR A:0x604b1448
y.create.l HWIO_DEHR_VMIDMT_NSGFSRRESTORE_ADDR A:0x604b144c
y.create.l HWIO_DEHR_VMIDMT_NSGFSYNDR0_ADDR A:0x604b1450
y.create.l HWIO_DEHR_VMIDMT_NSGFSYNDR1_ADDR A:0x604b1454
y.create.l HWIO_DEHR_VMIDMT_NSGFSYNDR2_ADDR A:0x604b1458
y.create.l HWIO_DEHR_VMIDMT_NSVMIDMTCR0_ADDR A:0x604b1490
y.create.l HWIO_DEHR_VMIDMT_SSDR0_ADDR A:0x604b1080
y.create.l HWIO_DEHR_VMIDMT_MSDR0_ADDR A:0x604b1480
y.create.l HWIO_DEHR_VMIDMT_MCR_ADDR A:0x604b1494
y.create.l HWIO_DEHR_VMIDMT_S2VR0_ADDR A:0x604b1c00
y.create.l HWIO_DEHR_VMIDMT_AS2VR0_ADDR A:0x604b1e00
y.create.l HWIO_DIM_C00_DIM_CA_TOP_CFG_ADDR A:0x60480000
y.create.l HWIO_DIM_C00_DIM_CA_HW_INFO_ADDR A:0x60480004
y.create.l HWIO_DIM_C00_DIM_CA_HW_VERSION_ADDR A:0x60480008
y.create.l HWIO_DIM_C00_DIM_CA_PAD_CFG0_ADDR A:0x60480010
y.create.l HWIO_DIM_C00_DIM_CA_PAD_CFG1_ADDR A:0x60480014
y.create.l HWIO_DIM_C00_DIM_CA_PAD_CFG2_ADDR A:0x60480018
y.create.l HWIO_DIM_C00_DIM_CA_PAD_CFG3_ADDR A:0x6048001c
y.create.l HWIO_DIM_C00_DIM_CA_PAD_CFG4_ADDR A:0x60480020
y.create.l HWIO_DIM_C00_DDRPHY_CA_MISR_CFG_ADDR A:0x60480024
y.create.l HWIO_DIM_C00_DDRPHY_CA_MISR_EVEN_STATUS_ADDR A:0x60480028
y.create.l HWIO_DIM_C00_DDRPHY_CA_MISR_ODD_STATUS_ADDR A:0x6048002c
y.create.l HWIO_DIM_C00_DIM_CA_CDC_CTLR_CFG0_ADDR A:0x60480030
y.create.l HWIO_DIM_C00_DIM_CA_CDC_CTLR_CFG1_ADDR A:0x60480034
y.create.l HWIO_DIM_C00_DIM_CA_CDC_CAL_TIMER_CFG0_ADDR A:0x60480038
y.create.l HWIO_DIM_C00_DIM_CA_CDC_CAL_TIMER_CFG1_ADDR A:0x6048003c
y.create.l HWIO_DIM_C00_DIM_CA_CDC_REFCOUNT_CFG_ADDR A:0x60480040
y.create.l HWIO_DIM_C00_DIM_CA_CDC_COARSE_CAL_CFG_ADDR A:0x60480044
y.create.l HWIO_DIM_C00_DIM_CA_CDC_RSVD_CFG_ADDR A:0x60480048
y.create.l HWIO_DIM_C00_DIM_CA_CDC_OFFSET_CFG_ADDR A:0x6048004c
y.create.l HWIO_DIM_C00_DIM_CA_CDC_DELAY_CFG_ADDR A:0x60480050
y.create.l HWIO_DIM_C00_DIM_CA_CDC_SW_MODE_CFG_ADDR A:0x60480054
y.create.l HWIO_DIM_C00_DIM_CA_CDC_TEST_CFG_ADDR A:0x60480058
y.create.l HWIO_DIM_C00_DIM_CA_CDC_SW_OVRD_CFG_ADDR A:0x6048005c
y.create.l HWIO_DIM_C00_DIM_CA_CDC_STATUS0_ADDR A:0x60480070
y.create.l HWIO_DIM_C00_DIM_CA_CDC_STATUS1_ADDR A:0x60480074
y.create.l HWIO_DIM_C00_DIM_CA_CDC_STATUS2_ADDR A:0x60480078
y.create.l HWIO_DIM_C00_DIM_CA_CDC_STATUS3_ADDR A:0x6048007c
y.create.l HWIO_DIM_C00_DIM_CA_IOC_CTLR_CFG_ADDR A:0x604800e0
y.create.l HWIO_DIM_C00_DIM_CA_IOC_CTLR_PNCNT_CFG_ADDR A:0x604800e4
y.create.l HWIO_DIM_C00_DIM_CA_IOC_CTLR_TIMER_CFG_ADDR A:0x604800e8
y.create.l HWIO_DIM_C00_DIM_CA_IOC_CTLR_TIMER_STATUS_ADDR A:0x604800ec
y.create.l HWIO_DIM_C00_DIM_CA_IOC_CTLR_CHAR_CFG_ADDR A:0x604800f0
y.create.l HWIO_DIM_C00_DIM_CA_IOC_CTLR_STATUS_ADDR A:0x604800f4
y.create.l HWIO_DIM_C00_DIM_CA_CA_IOC_SLV_CFG_ADDR A:0x60480100
y.create.l HWIO_DIM_C00_DIM_CA_CA_IOC_SLV_STATUS_ADDR A:0x60480104
y.create.l HWIO_DIM_C00_DIM_CA_CK_IOC_SLV_CFG_ADDR A:0x60480110
y.create.l HWIO_DIM_C00_DIM_CA_CK_IOC_SLV_STATUS_ADDR A:0x60480114
y.create.l HWIO_DIM_D00_DIM_DQ_TOP_CFG_ADDR A:0x60480800
y.create.l HWIO_DIM_D00_DIM_DQ_HW_INFO_ADDR A:0x60480804
y.create.l HWIO_DIM_D00_DIM_DQ_HW_VERSION_ADDR A:0x60480808
y.create.l HWIO_DIM_D00_DIM_DQ_PAD_CFG0_ADDR A:0x60480810
y.create.l HWIO_DIM_D00_DIM_DQ_PAD_CFG1_ADDR A:0x60480814
y.create.l HWIO_DIM_D00_DIM_DQ_PAD_CFG2_ADDR A:0x60480818
y.create.l HWIO_DIM_D00_DIM_DQ_PAD_CFG3_ADDR A:0x60480820
y.create.l HWIO_DIM_D00_DDRPHY_DQ_MISR_CFG_ADDR A:0x6048080c
y.create.l HWIO_DIM_D00_DDRPHY_DQ_MISR_EVEN_STATUS_ADDR A:0x60480828
y.create.l HWIO_DIM_D00_DDRPHY_DQ_MISR_ODD_STATUS_ADDR A:0x6048082c
y.create.l HWIO_DIM_D00_DIM_DQ_CDC_CTLR_CFG0_ADDR A:0x60480830
y.create.l HWIO_DIM_D00_DIM_DQ_CDC_CTLR_CFG1_ADDR A:0x60480834
y.create.l HWIO_DIM_D00_DIM_DQ_CDC_CAL_TIMER_CFG0_ADDR A:0x60480838
y.create.l HWIO_DIM_D00_DIM_DQ_CDC_CAL_TIMER_CFG1_ADDR A:0x6048083c
y.create.l HWIO_DIM_D00_DIM_DQ_CDC_REFCOUNT_CFG_ADDR A:0x60480840
y.create.l HWIO_DIM_D00_DIM_DQ_CDC_COARSE_CAL_CFG_ADDR A:0x60480844
y.create.l HWIO_DIM_D00_DIM_DQ_CDC_RSVD_CFG_ADDR A:0x60480848
y.create.l HWIO_DIM_D00_DIM_DQ_RD_CDC_OFFSET_CFG_ADDR A:0x6048084c
y.create.l HWIO_DIM_D00_DIM_DQ_RD_CDC_DELAY_CFG_ADDR A:0x60480850
y.create.l HWIO_DIM_D00_DIM_DQ_RD_CDC_SW_MODE_CFG_ADDR A:0x60480854
y.create.l HWIO_DIM_D00_DIM_DQ_RD_CDC_TEST_CFG_ADDR A:0x60480858
y.create.l HWIO_DIM_D00_DIM_DQ_RD_CDC_SW_OVRD_CFG_ADDR A:0x6048085c
y.create.l HWIO_DIM_D00_DIM_DQ_RD_CDC_SLAVE_DDA_CFG_ADDR A:0x60480860
y.create.l HWIO_DIM_D00_DIM_DQ_RD_CDC_STATUS0_ADDR A:0x60480870
y.create.l HWIO_DIM_D00_DIM_DQ_RD_CDC_STATUS1_ADDR A:0x60480874
y.create.l HWIO_DIM_D00_DIM_DQ_RD_CDC_STATUS2_ADDR A:0x60480878
y.create.l HWIO_DIM_D00_DIM_DQ_RD_CDC_STATUS3_ADDR A:0x6048087c
y.create.l HWIO_DIM_D00_DIM_DQ_RD_CDC_STATUS4_ADDR A:0x60480880
y.create.l HWIO_DIM_D00_DIM_DQ_WR_CDC_OFFSET_CFG_ADDR A:0x604808ac
y.create.l HWIO_DIM_D00_DIM_DQ_WR_CDC_DELAY_CFG_ADDR A:0x604808b0
y.create.l HWIO_DIM_D00_DIM_DQ_WR_CDC_SW_MODE_CFG_ADDR A:0x604808b4
y.create.l HWIO_DIM_D00_DIM_DQ_WR_CDC_TEST_CFG_ADDR A:0x604808b8
y.create.l HWIO_DIM_D00_DIM_DQ_WR_CDC_SW_OVRD_CFG_ADDR A:0x604808bc
y.create.l HWIO_DIM_D00_DIM_DQ_WR_CDC_STATUS0_ADDR A:0x604808d0
y.create.l HWIO_DIM_D00_DIM_DQ_WR_CDC_STATUS1_ADDR A:0x604808d4
y.create.l HWIO_DIM_D00_DIM_DQ_WR_CDC_STATUS2_ADDR A:0x604808d8
y.create.l HWIO_DIM_D00_DIM_DQ_WR_CDC_STATUS3_ADDR A:0x604808dc
y.create.l HWIO_DIM_D00_DIM_DQ_DQ_IOC_SLV_CFG_ADDR A:0x60480900
y.create.l HWIO_DIM_D00_DIM_DQ_DQ_IOC_SLV_STATUS_ADDR A:0x60480904
y.create.l HWIO_DIM_D00_DIM_DQ_DQS_IOC_SLV_CFG_ADDR A:0x60480910
y.create.l HWIO_DIM_D00_DIM_DQ_DQS_IOC_SLV_STATUS_ADDR A:0x60480914
y.create.l HWIO_DIM_D01_DIM_DQ_TOP_CFG_ADDR A:0x60481000
y.create.l HWIO_DIM_D01_DIM_DQ_HW_INFO_ADDR A:0x60481004
y.create.l HWIO_DIM_D01_DIM_DQ_HW_VERSION_ADDR A:0x60481008
y.create.l HWIO_DIM_D01_DIM_DQ_PAD_CFG0_ADDR A:0x60481010
y.create.l HWIO_DIM_D01_DIM_DQ_PAD_CFG1_ADDR A:0x60481014
y.create.l HWIO_DIM_D01_DIM_DQ_PAD_CFG2_ADDR A:0x60481018
y.create.l HWIO_DIM_D01_DIM_DQ_PAD_CFG3_ADDR A:0x60481020
y.create.l HWIO_DIM_D01_DDRPHY_DQ_MISR_CFG_ADDR A:0x6048100c
y.create.l HWIO_DIM_D01_DDRPHY_DQ_MISR_EVEN_STATUS_ADDR A:0x60481028
y.create.l HWIO_DIM_D01_DDRPHY_DQ_MISR_ODD_STATUS_ADDR A:0x6048102c
y.create.l HWIO_DIM_D01_DIM_DQ_CDC_CTLR_CFG0_ADDR A:0x60481030
y.create.l HWIO_DIM_D01_DIM_DQ_CDC_CTLR_CFG1_ADDR A:0x60481034
y.create.l HWIO_DIM_D01_DIM_DQ_CDC_CAL_TIMER_CFG0_ADDR A:0x60481038
y.create.l HWIO_DIM_D01_DIM_DQ_CDC_CAL_TIMER_CFG1_ADDR A:0x6048103c
y.create.l HWIO_DIM_D01_DIM_DQ_CDC_REFCOUNT_CFG_ADDR A:0x60481040
y.create.l HWIO_DIM_D01_DIM_DQ_CDC_COARSE_CAL_CFG_ADDR A:0x60481044
y.create.l HWIO_DIM_D01_DIM_DQ_CDC_RSVD_CFG_ADDR A:0x60481048
y.create.l HWIO_DIM_D01_DIM_DQ_RD_CDC_OFFSET_CFG_ADDR A:0x6048104c
y.create.l HWIO_DIM_D01_DIM_DQ_RD_CDC_DELAY_CFG_ADDR A:0x60481050
y.create.l HWIO_DIM_D01_DIM_DQ_RD_CDC_SW_MODE_CFG_ADDR A:0x60481054
y.create.l HWIO_DIM_D01_DIM_DQ_RD_CDC_TEST_CFG_ADDR A:0x60481058
y.create.l HWIO_DIM_D01_DIM_DQ_RD_CDC_SW_OVRD_CFG_ADDR A:0x6048105c
y.create.l HWIO_DIM_D01_DIM_DQ_RD_CDC_SLAVE_DDA_CFG_ADDR A:0x60481060
y.create.l HWIO_DIM_D01_DIM_DQ_RD_CDC_STATUS0_ADDR A:0x60481070
y.create.l HWIO_DIM_D01_DIM_DQ_RD_CDC_STATUS1_ADDR A:0x60481074
y.create.l HWIO_DIM_D01_DIM_DQ_RD_CDC_STATUS2_ADDR A:0x60481078
y.create.l HWIO_DIM_D01_DIM_DQ_RD_CDC_STATUS3_ADDR A:0x6048107c
y.create.l HWIO_DIM_D01_DIM_DQ_RD_CDC_STATUS4_ADDR A:0x60481080
y.create.l HWIO_DIM_D01_DIM_DQ_WR_CDC_OFFSET_CFG_ADDR A:0x604810ac
y.create.l HWIO_DIM_D01_DIM_DQ_WR_CDC_DELAY_CFG_ADDR A:0x604810b0
y.create.l HWIO_DIM_D01_DIM_DQ_WR_CDC_SW_MODE_CFG_ADDR A:0x604810b4
y.create.l HWIO_DIM_D01_DIM_DQ_WR_CDC_TEST_CFG_ADDR A:0x604810b8
y.create.l HWIO_DIM_D01_DIM_DQ_WR_CDC_SW_OVRD_CFG_ADDR A:0x604810bc
y.create.l HWIO_DIM_D01_DIM_DQ_WR_CDC_STATUS0_ADDR A:0x604810d0
y.create.l HWIO_DIM_D01_DIM_DQ_WR_CDC_STATUS1_ADDR A:0x604810d4
y.create.l HWIO_DIM_D01_DIM_DQ_WR_CDC_STATUS2_ADDR A:0x604810d8
y.create.l HWIO_DIM_D01_DIM_DQ_WR_CDC_STATUS3_ADDR A:0x604810dc
y.create.l HWIO_DIM_D01_DIM_DQ_DQ_IOC_SLV_CFG_ADDR A:0x60481100
y.create.l HWIO_DIM_D01_DIM_DQ_DQ_IOC_SLV_STATUS_ADDR A:0x60481104
y.create.l HWIO_DIM_D01_DIM_DQ_DQS_IOC_SLV_CFG_ADDR A:0x60481110
y.create.l HWIO_DIM_D01_DIM_DQ_DQS_IOC_SLV_STATUS_ADDR A:0x60481114
y.create.l HWIO_DIM_D02_DIM_DQ_TOP_CFG_ADDR A:0x60481800
y.create.l HWIO_DIM_D02_DIM_DQ_HW_INFO_ADDR A:0x60481804
y.create.l HWIO_DIM_D02_DIM_DQ_HW_VERSION_ADDR A:0x60481808
y.create.l HWIO_DIM_D02_DIM_DQ_PAD_CFG0_ADDR A:0x60481810
y.create.l HWIO_DIM_D02_DIM_DQ_PAD_CFG1_ADDR A:0x60481814
y.create.l HWIO_DIM_D02_DIM_DQ_PAD_CFG2_ADDR A:0x60481818
y.create.l HWIO_DIM_D02_DIM_DQ_PAD_CFG3_ADDR A:0x60481820
y.create.l HWIO_DIM_D02_DDRPHY_DQ_MISR_CFG_ADDR A:0x6048180c
y.create.l HWIO_DIM_D02_DDRPHY_DQ_MISR_EVEN_STATUS_ADDR A:0x60481828
y.create.l HWIO_DIM_D02_DDRPHY_DQ_MISR_ODD_STATUS_ADDR A:0x6048182c
y.create.l HWIO_DIM_D02_DIM_DQ_CDC_CTLR_CFG0_ADDR A:0x60481830
y.create.l HWIO_DIM_D02_DIM_DQ_CDC_CTLR_CFG1_ADDR A:0x60481834
y.create.l HWIO_DIM_D02_DIM_DQ_CDC_CAL_TIMER_CFG0_ADDR A:0x60481838
y.create.l HWIO_DIM_D02_DIM_DQ_CDC_CAL_TIMER_CFG1_ADDR A:0x6048183c
y.create.l HWIO_DIM_D02_DIM_DQ_CDC_REFCOUNT_CFG_ADDR A:0x60481840
y.create.l HWIO_DIM_D02_DIM_DQ_CDC_COARSE_CAL_CFG_ADDR A:0x60481844
y.create.l HWIO_DIM_D02_DIM_DQ_CDC_RSVD_CFG_ADDR A:0x60481848
y.create.l HWIO_DIM_D02_DIM_DQ_RD_CDC_OFFSET_CFG_ADDR A:0x6048184c
y.create.l HWIO_DIM_D02_DIM_DQ_RD_CDC_DELAY_CFG_ADDR A:0x60481850
y.create.l HWIO_DIM_D02_DIM_DQ_RD_CDC_SW_MODE_CFG_ADDR A:0x60481854
y.create.l HWIO_DIM_D02_DIM_DQ_RD_CDC_TEST_CFG_ADDR A:0x60481858
y.create.l HWIO_DIM_D02_DIM_DQ_RD_CDC_SW_OVRD_CFG_ADDR A:0x6048185c
y.create.l HWIO_DIM_D02_DIM_DQ_RD_CDC_SLAVE_DDA_CFG_ADDR A:0x60481860
y.create.l HWIO_DIM_D02_DIM_DQ_RD_CDC_STATUS0_ADDR A:0x60481870
y.create.l HWIO_DIM_D02_DIM_DQ_RD_CDC_STATUS1_ADDR A:0x60481874
y.create.l HWIO_DIM_D02_DIM_DQ_RD_CDC_STATUS2_ADDR A:0x60481878
y.create.l HWIO_DIM_D02_DIM_DQ_RD_CDC_STATUS3_ADDR A:0x6048187c
y.create.l HWIO_DIM_D02_DIM_DQ_RD_CDC_STATUS4_ADDR A:0x60481880
y.create.l HWIO_DIM_D02_DIM_DQ_WR_CDC_OFFSET_CFG_ADDR A:0x604818ac
y.create.l HWIO_DIM_D02_DIM_DQ_WR_CDC_DELAY_CFG_ADDR A:0x604818b0
y.create.l HWIO_DIM_D02_DIM_DQ_WR_CDC_SW_MODE_CFG_ADDR A:0x604818b4
y.create.l HWIO_DIM_D02_DIM_DQ_WR_CDC_TEST_CFG_ADDR A:0x604818b8
y.create.l HWIO_DIM_D02_DIM_DQ_WR_CDC_SW_OVRD_CFG_ADDR A:0x604818bc
y.create.l HWIO_DIM_D02_DIM_DQ_WR_CDC_STATUS0_ADDR A:0x604818d0
y.create.l HWIO_DIM_D02_DIM_DQ_WR_CDC_STATUS1_ADDR A:0x604818d4
y.create.l HWIO_DIM_D02_DIM_DQ_WR_CDC_STATUS2_ADDR A:0x604818d8
y.create.l HWIO_DIM_D02_DIM_DQ_WR_CDC_STATUS3_ADDR A:0x604818dc
y.create.l HWIO_DIM_D02_DIM_DQ_DQ_IOC_SLV_CFG_ADDR A:0x60481900
y.create.l HWIO_DIM_D02_DIM_DQ_DQ_IOC_SLV_STATUS_ADDR A:0x60481904
y.create.l HWIO_DIM_D02_DIM_DQ_DQS_IOC_SLV_CFG_ADDR A:0x60481910
y.create.l HWIO_DIM_D02_DIM_DQ_DQS_IOC_SLV_STATUS_ADDR A:0x60481914
y.create.l HWIO_DIM_D03_DIM_DQ_TOP_CFG_ADDR A:0x60482000
y.create.l HWIO_DIM_D03_DIM_DQ_HW_INFO_ADDR A:0x60482004
y.create.l HWIO_DIM_D03_DIM_DQ_HW_VERSION_ADDR A:0x60482008
y.create.l HWIO_DIM_D03_DIM_DQ_PAD_CFG0_ADDR A:0x60482010
y.create.l HWIO_DIM_D03_DIM_DQ_PAD_CFG1_ADDR A:0x60482014
y.create.l HWIO_DIM_D03_DIM_DQ_PAD_CFG2_ADDR A:0x60482018
y.create.l HWIO_DIM_D03_DIM_DQ_PAD_CFG3_ADDR A:0x60482020
y.create.l HWIO_DIM_D03_DDRPHY_DQ_MISR_CFG_ADDR A:0x6048200c
y.create.l HWIO_DIM_D03_DDRPHY_DQ_MISR_EVEN_STATUS_ADDR A:0x60482028
y.create.l HWIO_DIM_D03_DDRPHY_DQ_MISR_ODD_STATUS_ADDR A:0x6048202c
y.create.l HWIO_DIM_D03_DIM_DQ_CDC_CTLR_CFG0_ADDR A:0x60482030
y.create.l HWIO_DIM_D03_DIM_DQ_CDC_CTLR_CFG1_ADDR A:0x60482034
y.create.l HWIO_DIM_D03_DIM_DQ_CDC_CAL_TIMER_CFG0_ADDR A:0x60482038
y.create.l HWIO_DIM_D03_DIM_DQ_CDC_CAL_TIMER_CFG1_ADDR A:0x6048203c
y.create.l HWIO_DIM_D03_DIM_DQ_CDC_REFCOUNT_CFG_ADDR A:0x60482040
y.create.l HWIO_DIM_D03_DIM_DQ_CDC_COARSE_CAL_CFG_ADDR A:0x60482044
y.create.l HWIO_DIM_D03_DIM_DQ_CDC_RSVD_CFG_ADDR A:0x60482048
y.create.l HWIO_DIM_D03_DIM_DQ_RD_CDC_OFFSET_CFG_ADDR A:0x6048204c
y.create.l HWIO_DIM_D03_DIM_DQ_RD_CDC_DELAY_CFG_ADDR A:0x60482050
y.create.l HWIO_DIM_D03_DIM_DQ_RD_CDC_SW_MODE_CFG_ADDR A:0x60482054
y.create.l HWIO_DIM_D03_DIM_DQ_RD_CDC_TEST_CFG_ADDR A:0x60482058
y.create.l HWIO_DIM_D03_DIM_DQ_RD_CDC_SW_OVRD_CFG_ADDR A:0x6048205c
y.create.l HWIO_DIM_D03_DIM_DQ_RD_CDC_SLAVE_DDA_CFG_ADDR A:0x60482060
y.create.l HWIO_DIM_D03_DIM_DQ_RD_CDC_STATUS0_ADDR A:0x60482070
y.create.l HWIO_DIM_D03_DIM_DQ_RD_CDC_STATUS1_ADDR A:0x60482074
y.create.l HWIO_DIM_D03_DIM_DQ_RD_CDC_STATUS2_ADDR A:0x60482078
y.create.l HWIO_DIM_D03_DIM_DQ_RD_CDC_STATUS3_ADDR A:0x6048207c
y.create.l HWIO_DIM_D03_DIM_DQ_RD_CDC_STATUS4_ADDR A:0x60482080
y.create.l HWIO_DIM_D03_DIM_DQ_WR_CDC_OFFSET_CFG_ADDR A:0x604820ac
y.create.l HWIO_DIM_D03_DIM_DQ_WR_CDC_DELAY_CFG_ADDR A:0x604820b0
y.create.l HWIO_DIM_D03_DIM_DQ_WR_CDC_SW_MODE_CFG_ADDR A:0x604820b4
y.create.l HWIO_DIM_D03_DIM_DQ_WR_CDC_TEST_CFG_ADDR A:0x604820b8
y.create.l HWIO_DIM_D03_DIM_DQ_WR_CDC_SW_OVRD_CFG_ADDR A:0x604820bc
y.create.l HWIO_DIM_D03_DIM_DQ_WR_CDC_STATUS0_ADDR A:0x604820d0
y.create.l HWIO_DIM_D03_DIM_DQ_WR_CDC_STATUS1_ADDR A:0x604820d4
y.create.l HWIO_DIM_D03_DIM_DQ_WR_CDC_STATUS2_ADDR A:0x604820d8
y.create.l HWIO_DIM_D03_DIM_DQ_WR_CDC_STATUS3_ADDR A:0x604820dc
y.create.l HWIO_DIM_D03_DIM_DQ_DQ_IOC_SLV_CFG_ADDR A:0x60482100
y.create.l HWIO_DIM_D03_DIM_DQ_DQ_IOC_SLV_STATUS_ADDR A:0x60482104
y.create.l HWIO_DIM_D03_DIM_DQ_DQS_IOC_SLV_CFG_ADDR A:0x60482110
y.create.l HWIO_DIM_D03_DIM_DQ_DQS_IOC_SLV_STATUS_ADDR A:0x60482114
y.create.l HWIO_EBI1_HW_VERSION_ADDR A:0x6049f000
y.create.l HWIO_EBI1_HW_INFO_ADDR A:0x6049f004
y.create.l HWIO_EBI1_AHB2PHY_BROADCAST_EN_CFG_LOWER_ADDR A:0x6049f008
y.create.l HWIO_EBI1_AHB2PHY_BROADCAST_EN_CFG_UPPER_ADDR A:0x6049f00c
y.create.l HWIO_EBI1_AHB2PHY_TOP_CFG_ADDR A:0x6049f010
y.create.l HWIO_EBI1_AHB2PHY_DEBUG_BUS_CFG_ADDR A:0x6049f014
y.create.l HWIO_EBI1_AHB2PHY_BROADCAST_ADDRESS_SPACE_0_ADDR A:0x6049f800
y.create.l HWIO_EBI1_AHB2PHY_BROADCAST_ADDRESS_SPACE_1_ADDR A:0x6049f804
y.create.l HWIO_EBI1_AHB2PHY_BROADCAST_ADDRESS_SPACE_2_ADDR A:0x6049f808
y.create.l HWIO_EBI1_AHB2PHY_BROADCAST_ADDRESS_SPACE_3_ADDR A:0x6049f80c
y.create.l HWIO_EBI1_AHB2PHY_BROADCAST_ADDRESS_SPACE_4_ADDR A:0x6049f810
y.create.l HWIO_EBI1_AHB2PHY_BROADCAST_ADDRESS_SPACE_5_ADDR A:0x6049f814
y.create.l HWIO_EBI1_AHB2PHY_BROADCAST_ADDRESS_SPACE_6_ADDR A:0x6049f818
y.create.l HWIO_EBI1_AHB2PHY_BROADCAST_ADDRESS_SPACE_7_ADDR A:0x6049f81c
y.create.l HWIO_EBI1_AHB2PHY_BROADCAST_ADDRESS_SPACE_8_ADDR A:0x6049f820
y.create.l HWIO_EBI1_AHB2PHY_BROADCAST_ADDRESS_SPACE_9_ADDR A:0x6049f824
y.create.l HWIO_IPA_BAM_CTRL_ADDR A:0x67904000
y.create.l HWIO_IPA_BAM_TIMER_ADDR A:0x67904040
y.create.l HWIO_IPA_BAM_TIMER_CTRL_ADDR A:0x67904044
y.create.l HWIO_IPA_BAM_DESC_CNT_TRSHLD_ADDR A:0x67904008
y.create.l HWIO_IPA_BAM_IRQ_STTS_ADDR A:0x67904014
y.create.l HWIO_IPA_BAM_IRQ_CLR_ADDR A:0x67904018
y.create.l HWIO_IPA_BAM_IRQ_EN_ADDR A:0x6790401c
y.create.l HWIO_IPA_BAM_CNFG_BITS_ADDR A:0x6790407c
y.create.l HWIO_IPA_BAM_CNFG_BITS_2_ADDR A:0x67904084
y.create.l HWIO_IPA_BAM_REVISION_ADDR A:0x67905000
y.create.l HWIO_IPA_BAM_SW_VERSION_ADDR A:0x67905004
y.create.l HWIO_IPA_BAM_NUM_PIPES_ADDR A:0x67905008
y.create.l HWIO_IPA_BAM_TEST_BUS_SEL_ADDR A:0x67905010
y.create.l HWIO_IPA_BAM_TEST_BUS_REG_ADDR A:0x67905014
y.create.l HWIO_IPA_BAM_AHB_MASTER_ERR_CTRLS_ADDR A:0x67905024
y.create.l HWIO_IPA_BAM_AHB_MASTER_ERR_ADDR_ADDR A:0x67905028
y.create.l HWIO_IPA_BAM_AHB_MASTER_ERR_DATA_ADDR A:0x6790502c
y.create.l HWIO_IPA_BAM_AHB_MASTER_ERR_ADDR_LSB_ADDR A:0x67905100
y.create.l HWIO_IPA_BAM_AHB_MASTER_ERR_ADDR_MSB_ADDR A:0x67905104
y.create.l HWIO_IPA_BAM_TRUST_REG_ADDR A:0x67906000
y.create.l HWIO_IPA_BAM_P_TRUST_REG0_ADDR A:0x67906020
y.create.l HWIO_IPA_BAM_P_TRUST_REG1_ADDR A:0x67906024
y.create.l HWIO_IPA_BAM_P_TRUST_REG2_ADDR A:0x67906028
y.create.l HWIO_IPA_BAM_P_TRUST_REG3_ADDR A:0x6790602c
y.create.l HWIO_IPA_BAM_P_TRUST_REG4_ADDR A:0x67906030
y.create.l HWIO_IPA_BAM_P_TRUST_REG5_ADDR A:0x67906034
y.create.l HWIO_IPA_BAM_P_TRUST_REG6_ADDR A:0x67906038
y.create.l HWIO_IPA_BAM_P_TRUST_REG7_ADDR A:0x6790603c
y.create.l HWIO_IPA_BAM_P_TRUST_REG8_ADDR A:0x67906040
y.create.l HWIO_IPA_BAM_P_TRUST_REG9_ADDR A:0x67906044
y.create.l HWIO_IPA_BAM_IRQ_SRCS_EE0_ADDR A:0x67907000
y.create.l HWIO_IPA_BAM_IRQ_SRCS_EE1_ADDR A:0x67908000
y.create.l HWIO_IPA_BAM_IRQ_SRCS_EE2_ADDR A:0x67909000
y.create.l HWIO_IPA_BAM_IRQ_SRCS_EE3_ADDR A:0x6790a000
y.create.l HWIO_IPA_BAM_IRQ_SRCS_EE4_ADDR A:0x6790b000
y.create.l HWIO_IPA_BAM_IRQ_SRCS_EE5_ADDR A:0x6790c000
y.create.l HWIO_IPA_BAM_IRQ_SRCS_EE6_ADDR A:0x6790d000
y.create.l HWIO_IPA_BAM_IRQ_SRCS_EE7_ADDR A:0x6790e000
y.create.l HWIO_IPA_BAM_IRQ_SRCS_MSK_EE0_ADDR A:0x67907004
y.create.l HWIO_IPA_BAM_IRQ_SRCS_MSK_EE1_ADDR A:0x67908004
y.create.l HWIO_IPA_BAM_IRQ_SRCS_MSK_EE2_ADDR A:0x67909004
y.create.l HWIO_IPA_BAM_IRQ_SRCS_MSK_EE3_ADDR A:0x6790a004
y.create.l HWIO_IPA_BAM_IRQ_SRCS_MSK_EE4_ADDR A:0x6790b004
y.create.l HWIO_IPA_BAM_IRQ_SRCS_MSK_EE5_ADDR A:0x6790c004
y.create.l HWIO_IPA_BAM_IRQ_SRCS_MSK_EE6_ADDR A:0x6790d004
y.create.l HWIO_IPA_BAM_IRQ_SRCS_MSK_EE7_ADDR A:0x6790e004
y.create.l HWIO_IPA_BAM_IRQ_SRCS_UNMASKED_EE0_ADDR A:0x67907008
y.create.l HWIO_IPA_BAM_IRQ_SRCS_UNMASKED_EE1_ADDR A:0x67908008
y.create.l HWIO_IPA_BAM_IRQ_SRCS_UNMASKED_EE2_ADDR A:0x67909008
y.create.l HWIO_IPA_BAM_IRQ_SRCS_UNMASKED_EE3_ADDR A:0x6790a008
y.create.l HWIO_IPA_BAM_IRQ_SRCS_UNMASKED_EE4_ADDR A:0x6790b008
y.create.l HWIO_IPA_BAM_IRQ_SRCS_UNMASKED_EE5_ADDR A:0x6790c008
y.create.l HWIO_IPA_BAM_IRQ_SRCS_UNMASKED_EE6_ADDR A:0x6790d008
y.create.l HWIO_IPA_BAM_IRQ_SRCS_UNMASKED_EE7_ADDR A:0x6790e008
y.create.l HWIO_IPA_BAM_PIPE_ATTR_EE0_ADDR A:0x6790700c
y.create.l HWIO_IPA_BAM_PIPE_ATTR_EE1_ADDR A:0x6790800c
y.create.l HWIO_IPA_BAM_PIPE_ATTR_EE2_ADDR A:0x6790900c
y.create.l HWIO_IPA_BAM_PIPE_ATTR_EE3_ADDR A:0x6790a00c
y.create.l HWIO_IPA_BAM_PIPE_ATTR_EE4_ADDR A:0x6790b00c
y.create.l HWIO_IPA_BAM_PIPE_ATTR_EE5_ADDR A:0x6790c00c
y.create.l HWIO_IPA_BAM_PIPE_ATTR_EE6_ADDR A:0x6790d00c
y.create.l HWIO_IPA_BAM_PIPE_ATTR_EE7_ADDR A:0x6790e00c
y.create.l HWIO_IPA_BAM_IRQ_SRCS_ADDR A:0x67907010
y.create.l HWIO_IPA_BAM_IRQ_SRCS_MSK_ADDR A:0x67907014
y.create.l HWIO_IPA_BAM_IRQ_SRCS_UNMASKED_ADDR A:0x67907018
y.create.l HWIO_IPA_BAM_P_CTRL0_ADDR A:0x67917000
y.create.l HWIO_IPA_BAM_P_CTRL1_ADDR A:0x67918000
y.create.l HWIO_IPA_BAM_P_CTRL2_ADDR A:0x67919000
y.create.l HWIO_IPA_BAM_P_CTRL3_ADDR A:0x6791a000
y.create.l HWIO_IPA_BAM_P_CTRL4_ADDR A:0x6791b000
y.create.l HWIO_IPA_BAM_P_CTRL5_ADDR A:0x6791c000
y.create.l HWIO_IPA_BAM_P_CTRL6_ADDR A:0x6791d000
y.create.l HWIO_IPA_BAM_P_CTRL7_ADDR A:0x6791e000
y.create.l HWIO_IPA_BAM_P_CTRL8_ADDR A:0x6791f000
y.create.l HWIO_IPA_BAM_P_CTRL9_ADDR A:0x67920000
y.create.l HWIO_IPA_BAM_P_RST0_ADDR A:0x67917004
y.create.l HWIO_IPA_BAM_P_RST1_ADDR A:0x67918004
y.create.l HWIO_IPA_BAM_P_RST2_ADDR A:0x67919004
y.create.l HWIO_IPA_BAM_P_RST3_ADDR A:0x6791a004
y.create.l HWIO_IPA_BAM_P_RST4_ADDR A:0x6791b004
y.create.l HWIO_IPA_BAM_P_RST5_ADDR A:0x6791c004
y.create.l HWIO_IPA_BAM_P_RST6_ADDR A:0x6791d004
y.create.l HWIO_IPA_BAM_P_RST7_ADDR A:0x6791e004
y.create.l HWIO_IPA_BAM_P_RST8_ADDR A:0x6791f004
y.create.l HWIO_IPA_BAM_P_RST9_ADDR A:0x67920004
y.create.l HWIO_IPA_BAM_P_HALT0_ADDR A:0x67917008
y.create.l HWIO_IPA_BAM_P_HALT1_ADDR A:0x67918008
y.create.l HWIO_IPA_BAM_P_HALT2_ADDR A:0x67919008
y.create.l HWIO_IPA_BAM_P_HALT3_ADDR A:0x6791a008
y.create.l HWIO_IPA_BAM_P_HALT4_ADDR A:0x6791b008
y.create.l HWIO_IPA_BAM_P_HALT5_ADDR A:0x6791c008
y.create.l HWIO_IPA_BAM_P_HALT6_ADDR A:0x6791d008
y.create.l HWIO_IPA_BAM_P_HALT7_ADDR A:0x6791e008
y.create.l HWIO_IPA_BAM_P_HALT8_ADDR A:0x6791f008
y.create.l HWIO_IPA_BAM_P_HALT9_ADDR A:0x67920008
y.create.l HWIO_IPA_BAM_P_IRQ_STTS0_ADDR A:0x67917010
y.create.l HWIO_IPA_BAM_P_IRQ_STTS1_ADDR A:0x67918010
y.create.l HWIO_IPA_BAM_P_IRQ_STTS2_ADDR A:0x67919010
y.create.l HWIO_IPA_BAM_P_IRQ_STTS3_ADDR A:0x6791a010
y.create.l HWIO_IPA_BAM_P_IRQ_STTS4_ADDR A:0x6791b010
y.create.l HWIO_IPA_BAM_P_IRQ_STTS5_ADDR A:0x6791c010
y.create.l HWIO_IPA_BAM_P_IRQ_STTS6_ADDR A:0x6791d010
y.create.l HWIO_IPA_BAM_P_IRQ_STTS7_ADDR A:0x6791e010
y.create.l HWIO_IPA_BAM_P_IRQ_STTS8_ADDR A:0x6791f010
y.create.l HWIO_IPA_BAM_P_IRQ_STTS9_ADDR A:0x67920010
y.create.l HWIO_IPA_BAM_P_IRQ_CLR0_ADDR A:0x67917014
y.create.l HWIO_IPA_BAM_P_IRQ_CLR1_ADDR A:0x67918014
y.create.l HWIO_IPA_BAM_P_IRQ_CLR2_ADDR A:0x67919014
y.create.l HWIO_IPA_BAM_P_IRQ_CLR3_ADDR A:0x6791a014
y.create.l HWIO_IPA_BAM_P_IRQ_CLR4_ADDR A:0x6791b014
y.create.l HWIO_IPA_BAM_P_IRQ_CLR5_ADDR A:0x6791c014
y.create.l HWIO_IPA_BAM_P_IRQ_CLR6_ADDR A:0x6791d014
y.create.l HWIO_IPA_BAM_P_IRQ_CLR7_ADDR A:0x6791e014
y.create.l HWIO_IPA_BAM_P_IRQ_CLR8_ADDR A:0x6791f014
y.create.l HWIO_IPA_BAM_P_IRQ_CLR9_ADDR A:0x67920014
y.create.l HWIO_IPA_BAM_P_IRQ_EN0_ADDR A:0x67917018
y.create.l HWIO_IPA_BAM_P_IRQ_EN1_ADDR A:0x67918018
y.create.l HWIO_IPA_BAM_P_IRQ_EN2_ADDR A:0x67919018
y.create.l HWIO_IPA_BAM_P_IRQ_EN3_ADDR A:0x6791a018
y.create.l HWIO_IPA_BAM_P_IRQ_EN4_ADDR A:0x6791b018
y.create.l HWIO_IPA_BAM_P_IRQ_EN5_ADDR A:0x6791c018
y.create.l HWIO_IPA_BAM_P_IRQ_EN6_ADDR A:0x6791d018
y.create.l HWIO_IPA_BAM_P_IRQ_EN7_ADDR A:0x6791e018
y.create.l HWIO_IPA_BAM_P_IRQ_EN8_ADDR A:0x6791f018
y.create.l HWIO_IPA_BAM_P_IRQ_EN9_ADDR A:0x67920018
y.create.l HWIO_IPA_BAM_P_TIMER0_ADDR A:0x6791701c
y.create.l HWIO_IPA_BAM_P_TIMER1_ADDR A:0x6791801c
y.create.l HWIO_IPA_BAM_P_TIMER2_ADDR A:0x6791901c
y.create.l HWIO_IPA_BAM_P_TIMER3_ADDR A:0x6791a01c
y.create.l HWIO_IPA_BAM_P_TIMER4_ADDR A:0x6791b01c
y.create.l HWIO_IPA_BAM_P_TIMER5_ADDR A:0x6791c01c
y.create.l HWIO_IPA_BAM_P_TIMER6_ADDR A:0x6791d01c
y.create.l HWIO_IPA_BAM_P_TIMER7_ADDR A:0x6791e01c
y.create.l HWIO_IPA_BAM_P_TIMER8_ADDR A:0x6791f01c
y.create.l HWIO_IPA_BAM_P_TIMER9_ADDR A:0x6792001c
y.create.l HWIO_IPA_BAM_P_TIMER_CTRL0_ADDR A:0x67917020
y.create.l HWIO_IPA_BAM_P_TIMER_CTRL1_ADDR A:0x67918020
y.create.l HWIO_IPA_BAM_P_TIMER_CTRL2_ADDR A:0x67919020
y.create.l HWIO_IPA_BAM_P_TIMER_CTRL3_ADDR A:0x6791a020
y.create.l HWIO_IPA_BAM_P_TIMER_CTRL4_ADDR A:0x6791b020
y.create.l HWIO_IPA_BAM_P_TIMER_CTRL5_ADDR A:0x6791c020
y.create.l HWIO_IPA_BAM_P_TIMER_CTRL6_ADDR A:0x6791d020
y.create.l HWIO_IPA_BAM_P_TIMER_CTRL7_ADDR A:0x6791e020
y.create.l HWIO_IPA_BAM_P_TIMER_CTRL8_ADDR A:0x6791f020
y.create.l HWIO_IPA_BAM_P_TIMER_CTRL9_ADDR A:0x67920020
y.create.l HWIO_IPA_BAM_P_PRDCR_SDBND0_ADDR A:0x67917024
y.create.l HWIO_IPA_BAM_P_PRDCR_SDBND1_ADDR A:0x67918024
y.create.l HWIO_IPA_BAM_P_PRDCR_SDBND2_ADDR A:0x67919024
y.create.l HWIO_IPA_BAM_P_PRDCR_SDBND3_ADDR A:0x6791a024
y.create.l HWIO_IPA_BAM_P_PRDCR_SDBND4_ADDR A:0x6791b024
y.create.l HWIO_IPA_BAM_P_PRDCR_SDBND5_ADDR A:0x6791c024
y.create.l HWIO_IPA_BAM_P_PRDCR_SDBND6_ADDR A:0x6791d024
y.create.l HWIO_IPA_BAM_P_PRDCR_SDBND7_ADDR A:0x6791e024
y.create.l HWIO_IPA_BAM_P_PRDCR_SDBND8_ADDR A:0x6791f024
y.create.l HWIO_IPA_BAM_P_PRDCR_SDBND9_ADDR A:0x67920024
y.create.l HWIO_IPA_BAM_P_CNSMR_SDBND0_ADDR A:0x67917028
y.create.l HWIO_IPA_BAM_P_CNSMR_SDBND1_ADDR A:0x67918028
y.create.l HWIO_IPA_BAM_P_CNSMR_SDBND2_ADDR A:0x67919028
y.create.l HWIO_IPA_BAM_P_CNSMR_SDBND3_ADDR A:0x6791a028
y.create.l HWIO_IPA_BAM_P_CNSMR_SDBND4_ADDR A:0x6791b028
y.create.l HWIO_IPA_BAM_P_CNSMR_SDBND5_ADDR A:0x6791c028
y.create.l HWIO_IPA_BAM_P_CNSMR_SDBND6_ADDR A:0x6791d028
y.create.l HWIO_IPA_BAM_P_CNSMR_SDBND7_ADDR A:0x6791e028
y.create.l HWIO_IPA_BAM_P_CNSMR_SDBND8_ADDR A:0x6791f028
y.create.l HWIO_IPA_BAM_P_CNSMR_SDBND9_ADDR A:0x67920028
y.create.l HWIO_IPA_BAM_P_SW_OFSTS0_ADDR A:0x67917800
y.create.l HWIO_IPA_BAM_P_SW_OFSTS1_ADDR A:0x67918800
y.create.l HWIO_IPA_BAM_P_SW_OFSTS2_ADDR A:0x67919800
y.create.l HWIO_IPA_BAM_P_SW_OFSTS3_ADDR A:0x6791a800
y.create.l HWIO_IPA_BAM_P_SW_OFSTS4_ADDR A:0x6791b800
y.create.l HWIO_IPA_BAM_P_SW_OFSTS5_ADDR A:0x6791c800
y.create.l HWIO_IPA_BAM_P_SW_OFSTS6_ADDR A:0x6791d800
y.create.l HWIO_IPA_BAM_P_SW_OFSTS7_ADDR A:0x6791e800
y.create.l HWIO_IPA_BAM_P_SW_OFSTS8_ADDR A:0x6791f800
y.create.l HWIO_IPA_BAM_P_SW_OFSTS9_ADDR A:0x67920800
y.create.l HWIO_IPA_BAM_P_AU_PSM_CNTXT_1_0_ADDR A:0x67917804
y.create.l HWIO_IPA_BAM_P_AU_PSM_CNTXT_1_1_ADDR A:0x67918804
y.create.l HWIO_IPA_BAM_P_AU_PSM_CNTXT_1_2_ADDR A:0x67919804
y.create.l HWIO_IPA_BAM_P_AU_PSM_CNTXT_1_3_ADDR A:0x6791a804
y.create.l HWIO_IPA_BAM_P_AU_PSM_CNTXT_1_4_ADDR A:0x6791b804
y.create.l HWIO_IPA_BAM_P_AU_PSM_CNTXT_1_5_ADDR A:0x6791c804
y.create.l HWIO_IPA_BAM_P_AU_PSM_CNTXT_1_6_ADDR A:0x6791d804
y.create.l HWIO_IPA_BAM_P_AU_PSM_CNTXT_1_7_ADDR A:0x6791e804
y.create.l HWIO_IPA_BAM_P_AU_PSM_CNTXT_1_8_ADDR A:0x6791f804
y.create.l HWIO_IPA_BAM_P_AU_PSM_CNTXT_1_9_ADDR A:0x67920804
y.create.l HWIO_IPA_BAM_P_PSM_CNTXT_2_0_ADDR A:0x67917808
y.create.l HWIO_IPA_BAM_P_PSM_CNTXT_2_1_ADDR A:0x67918808
y.create.l HWIO_IPA_BAM_P_PSM_CNTXT_2_2_ADDR A:0x67919808
y.create.l HWIO_IPA_BAM_P_PSM_CNTXT_2_3_ADDR A:0x6791a808
y.create.l HWIO_IPA_BAM_P_PSM_CNTXT_2_4_ADDR A:0x6791b808
y.create.l HWIO_IPA_BAM_P_PSM_CNTXT_2_5_ADDR A:0x6791c808
y.create.l HWIO_IPA_BAM_P_PSM_CNTXT_2_6_ADDR A:0x6791d808
y.create.l HWIO_IPA_BAM_P_PSM_CNTXT_2_7_ADDR A:0x6791e808
y.create.l HWIO_IPA_BAM_P_PSM_CNTXT_2_8_ADDR A:0x6791f808
y.create.l HWIO_IPA_BAM_P_PSM_CNTXT_2_9_ADDR A:0x67920808
y.create.l HWIO_IPA_BAM_P_PSM_CNTXT_3_0_ADDR A:0x6791780c
y.create.l HWIO_IPA_BAM_P_PSM_CNTXT_3_1_ADDR A:0x6791880c
y.create.l HWIO_IPA_BAM_P_PSM_CNTXT_3_2_ADDR A:0x6791980c
y.create.l HWIO_IPA_BAM_P_PSM_CNTXT_3_3_ADDR A:0x6791a80c
y.create.l HWIO_IPA_BAM_P_PSM_CNTXT_3_4_ADDR A:0x6791b80c
y.create.l HWIO_IPA_BAM_P_PSM_CNTXT_3_5_ADDR A:0x6791c80c
y.create.l HWIO_IPA_BAM_P_PSM_CNTXT_3_6_ADDR A:0x6791d80c
y.create.l HWIO_IPA_BAM_P_PSM_CNTXT_3_7_ADDR A:0x6791e80c
y.create.l HWIO_IPA_BAM_P_PSM_CNTXT_3_8_ADDR A:0x6791f80c
y.create.l HWIO_IPA_BAM_P_PSM_CNTXT_3_9_ADDR A:0x6792080c
y.create.l HWIO_IPA_BAM_P_PSM_CNTXT_4_0_ADDR A:0x67917810
y.create.l HWIO_IPA_BAM_P_PSM_CNTXT_4_1_ADDR A:0x67918810
y.create.l HWIO_IPA_BAM_P_PSM_CNTXT_4_2_ADDR A:0x67919810
y.create.l HWIO_IPA_BAM_P_PSM_CNTXT_4_3_ADDR A:0x6791a810
y.create.l HWIO_IPA_BAM_P_PSM_CNTXT_4_4_ADDR A:0x6791b810
y.create.l HWIO_IPA_BAM_P_PSM_CNTXT_4_5_ADDR A:0x6791c810
y.create.l HWIO_IPA_BAM_P_PSM_CNTXT_4_6_ADDR A:0x6791d810
y.create.l HWIO_IPA_BAM_P_PSM_CNTXT_4_7_ADDR A:0x6791e810
y.create.l HWIO_IPA_BAM_P_PSM_CNTXT_4_8_ADDR A:0x6791f810
y.create.l HWIO_IPA_BAM_P_PSM_CNTXT_4_9_ADDR A:0x67920810
y.create.l HWIO_IPA_BAM_P_PSM_CNTXT_5_0_ADDR A:0x67917814
y.create.l HWIO_IPA_BAM_P_PSM_CNTXT_5_1_ADDR A:0x67918814
y.create.l HWIO_IPA_BAM_P_PSM_CNTXT_5_2_ADDR A:0x67919814
y.create.l HWIO_IPA_BAM_P_PSM_CNTXT_5_3_ADDR A:0x6791a814
y.create.l HWIO_IPA_BAM_P_PSM_CNTXT_5_4_ADDR A:0x6791b814
y.create.l HWIO_IPA_BAM_P_PSM_CNTXT_5_5_ADDR A:0x6791c814
y.create.l HWIO_IPA_BAM_P_PSM_CNTXT_5_6_ADDR A:0x6791d814
y.create.l HWIO_IPA_BAM_P_PSM_CNTXT_5_7_ADDR A:0x6791e814
y.create.l HWIO_IPA_BAM_P_PSM_CNTXT_5_8_ADDR A:0x6791f814
y.create.l HWIO_IPA_BAM_P_PSM_CNTXT_5_9_ADDR A:0x67920814
y.create.l HWIO_IPA_BAM_P_EVNT_REG0_ADDR A:0x67917818
y.create.l HWIO_IPA_BAM_P_EVNT_REG1_ADDR A:0x67918818
y.create.l HWIO_IPA_BAM_P_EVNT_REG2_ADDR A:0x67919818
y.create.l HWIO_IPA_BAM_P_EVNT_REG3_ADDR A:0x6791a818
y.create.l HWIO_IPA_BAM_P_EVNT_REG4_ADDR A:0x6791b818
y.create.l HWIO_IPA_BAM_P_EVNT_REG5_ADDR A:0x6791c818
y.create.l HWIO_IPA_BAM_P_EVNT_REG6_ADDR A:0x6791d818
y.create.l HWIO_IPA_BAM_P_EVNT_REG7_ADDR A:0x6791e818
y.create.l HWIO_IPA_BAM_P_EVNT_REG8_ADDR A:0x6791f818
y.create.l HWIO_IPA_BAM_P_EVNT_REG9_ADDR A:0x67920818
y.create.l HWIO_IPA_BAM_P_DESC_FIFO_ADDR0_ADDR A:0x6791781c
y.create.l HWIO_IPA_BAM_P_DESC_FIFO_ADDR1_ADDR A:0x6791881c
y.create.l HWIO_IPA_BAM_P_DESC_FIFO_ADDR2_ADDR A:0x6791981c
y.create.l HWIO_IPA_BAM_P_DESC_FIFO_ADDR3_ADDR A:0x6791a81c
y.create.l HWIO_IPA_BAM_P_DESC_FIFO_ADDR4_ADDR A:0x6791b81c
y.create.l HWIO_IPA_BAM_P_DESC_FIFO_ADDR5_ADDR A:0x6791c81c
y.create.l HWIO_IPA_BAM_P_DESC_FIFO_ADDR6_ADDR A:0x6791d81c
y.create.l HWIO_IPA_BAM_P_DESC_FIFO_ADDR7_ADDR A:0x6791e81c
y.create.l HWIO_IPA_BAM_P_DESC_FIFO_ADDR8_ADDR A:0x6791f81c
y.create.l HWIO_IPA_BAM_P_DESC_FIFO_ADDR9_ADDR A:0x6792081c
y.create.l HWIO_IPA_BAM_P_FIFO_SIZES0_ADDR A:0x67917820
y.create.l HWIO_IPA_BAM_P_FIFO_SIZES1_ADDR A:0x67918820
y.create.l HWIO_IPA_BAM_P_FIFO_SIZES2_ADDR A:0x67919820
y.create.l HWIO_IPA_BAM_P_FIFO_SIZES3_ADDR A:0x6791a820
y.create.l HWIO_IPA_BAM_P_FIFO_SIZES4_ADDR A:0x6791b820
y.create.l HWIO_IPA_BAM_P_FIFO_SIZES5_ADDR A:0x6791c820
y.create.l HWIO_IPA_BAM_P_FIFO_SIZES6_ADDR A:0x6791d820
y.create.l HWIO_IPA_BAM_P_FIFO_SIZES7_ADDR A:0x6791e820
y.create.l HWIO_IPA_BAM_P_FIFO_SIZES8_ADDR A:0x6791f820
y.create.l HWIO_IPA_BAM_P_FIFO_SIZES9_ADDR A:0x67920820
y.create.l HWIO_IPA_BAM_P_DATA_FIFO_ADDR0_ADDR A:0x67917824
y.create.l HWIO_IPA_BAM_P_DATA_FIFO_ADDR1_ADDR A:0x67918824
y.create.l HWIO_IPA_BAM_P_DATA_FIFO_ADDR2_ADDR A:0x67919824
y.create.l HWIO_IPA_BAM_P_DATA_FIFO_ADDR3_ADDR A:0x6791a824
y.create.l HWIO_IPA_BAM_P_DATA_FIFO_ADDR4_ADDR A:0x6791b824
y.create.l HWIO_IPA_BAM_P_DATA_FIFO_ADDR5_ADDR A:0x6791c824
y.create.l HWIO_IPA_BAM_P_DATA_FIFO_ADDR6_ADDR A:0x6791d824
y.create.l HWIO_IPA_BAM_P_DATA_FIFO_ADDR7_ADDR A:0x6791e824
y.create.l HWIO_IPA_BAM_P_DATA_FIFO_ADDR8_ADDR A:0x6791f824
y.create.l HWIO_IPA_BAM_P_DATA_FIFO_ADDR9_ADDR A:0x67920824
y.create.l HWIO_IPA_BAM_P_EVNT_GEN_TRSHLD0_ADDR A:0x67917828
y.create.l HWIO_IPA_BAM_P_EVNT_GEN_TRSHLD1_ADDR A:0x67918828
y.create.l HWIO_IPA_BAM_P_EVNT_GEN_TRSHLD2_ADDR A:0x67919828
y.create.l HWIO_IPA_BAM_P_EVNT_GEN_TRSHLD3_ADDR A:0x6791a828
y.create.l HWIO_IPA_BAM_P_EVNT_GEN_TRSHLD4_ADDR A:0x6791b828
y.create.l HWIO_IPA_BAM_P_EVNT_GEN_TRSHLD5_ADDR A:0x6791c828
y.create.l HWIO_IPA_BAM_P_EVNT_GEN_TRSHLD6_ADDR A:0x6791d828
y.create.l HWIO_IPA_BAM_P_EVNT_GEN_TRSHLD7_ADDR A:0x6791e828
y.create.l HWIO_IPA_BAM_P_EVNT_GEN_TRSHLD8_ADDR A:0x6791f828
y.create.l HWIO_IPA_BAM_P_EVNT_GEN_TRSHLD9_ADDR A:0x67920828
y.create.l HWIO_IPA_BAM_P_EVNT_DEST_ADDR0_ADDR A:0x6791782c
y.create.l HWIO_IPA_BAM_P_EVNT_DEST_ADDR1_ADDR A:0x6791882c
y.create.l HWIO_IPA_BAM_P_EVNT_DEST_ADDR2_ADDR A:0x6791982c
y.create.l HWIO_IPA_BAM_P_EVNT_DEST_ADDR3_ADDR A:0x6791a82c
y.create.l HWIO_IPA_BAM_P_EVNT_DEST_ADDR4_ADDR A:0x6791b82c
y.create.l HWIO_IPA_BAM_P_EVNT_DEST_ADDR5_ADDR A:0x6791c82c
y.create.l HWIO_IPA_BAM_P_EVNT_DEST_ADDR6_ADDR A:0x6791d82c
y.create.l HWIO_IPA_BAM_P_EVNT_DEST_ADDR7_ADDR A:0x6791e82c
y.create.l HWIO_IPA_BAM_P_EVNT_DEST_ADDR8_ADDR A:0x6791f82c
y.create.l HWIO_IPA_BAM_P_EVNT_DEST_ADDR9_ADDR A:0x6792082c
y.create.l HWIO_IPA_BAM_P_DF_CNTXT_0_ADDR A:0x67917830
y.create.l HWIO_IPA_BAM_P_DF_CNTXT_1_ADDR A:0x67918830
y.create.l HWIO_IPA_BAM_P_DF_CNTXT_2_ADDR A:0x67919830
y.create.l HWIO_IPA_BAM_P_DF_CNTXT_3_ADDR A:0x6791a830
y.create.l HWIO_IPA_BAM_P_DF_CNTXT_4_ADDR A:0x6791b830
y.create.l HWIO_IPA_BAM_P_DF_CNTXT_5_ADDR A:0x6791c830
y.create.l HWIO_IPA_BAM_P_DF_CNTXT_6_ADDR A:0x6791d830
y.create.l HWIO_IPA_BAM_P_DF_CNTXT_7_ADDR A:0x6791e830
y.create.l HWIO_IPA_BAM_P_DF_CNTXT_8_ADDR A:0x6791f830
y.create.l HWIO_IPA_BAM_P_DF_CNTXT_9_ADDR A:0x67920830
y.create.l HWIO_IPA_BAM_P_RETR_CNTXT_0_ADDR A:0x67917834
y.create.l HWIO_IPA_BAM_P_RETR_CNTXT_1_ADDR A:0x67918834
y.create.l HWIO_IPA_BAM_P_RETR_CNTXT_2_ADDR A:0x67919834
y.create.l HWIO_IPA_BAM_P_RETR_CNTXT_3_ADDR A:0x6791a834
y.create.l HWIO_IPA_BAM_P_RETR_CNTXT_4_ADDR A:0x6791b834
y.create.l HWIO_IPA_BAM_P_RETR_CNTXT_5_ADDR A:0x6791c834
y.create.l HWIO_IPA_BAM_P_RETR_CNTXT_6_ADDR A:0x6791d834
y.create.l HWIO_IPA_BAM_P_RETR_CNTXT_7_ADDR A:0x6791e834
y.create.l HWIO_IPA_BAM_P_RETR_CNTXT_8_ADDR A:0x6791f834
y.create.l HWIO_IPA_BAM_P_RETR_CNTXT_9_ADDR A:0x67920834
y.create.l HWIO_IPA_BAM_P_SI_CNTXT_0_ADDR A:0x67917838
y.create.l HWIO_IPA_BAM_P_SI_CNTXT_1_ADDR A:0x67918838
y.create.l HWIO_IPA_BAM_P_SI_CNTXT_2_ADDR A:0x67919838
y.create.l HWIO_IPA_BAM_P_SI_CNTXT_3_ADDR A:0x6791a838
y.create.l HWIO_IPA_BAM_P_SI_CNTXT_4_ADDR A:0x6791b838
y.create.l HWIO_IPA_BAM_P_SI_CNTXT_5_ADDR A:0x6791c838
y.create.l HWIO_IPA_BAM_P_SI_CNTXT_6_ADDR A:0x6791d838
y.create.l HWIO_IPA_BAM_P_SI_CNTXT_7_ADDR A:0x6791e838
y.create.l HWIO_IPA_BAM_P_SI_CNTXT_8_ADDR A:0x6791f838
y.create.l HWIO_IPA_BAM_P_SI_CNTXT_9_ADDR A:0x67920838
y.create.l HWIO_IPA_BAM_P_PSM_CNTXT_3_LSB0_ADDR A:0x67917900
y.create.l HWIO_IPA_BAM_P_PSM_CNTXT_3_LSB1_ADDR A:0x67918900
y.create.l HWIO_IPA_BAM_P_PSM_CNTXT_3_LSB2_ADDR A:0x67919900
y.create.l HWIO_IPA_BAM_P_PSM_CNTXT_3_LSB3_ADDR A:0x6791a900
y.create.l HWIO_IPA_BAM_P_PSM_CNTXT_3_LSB4_ADDR A:0x6791b900
y.create.l HWIO_IPA_BAM_P_PSM_CNTXT_3_LSB5_ADDR A:0x6791c900
y.create.l HWIO_IPA_BAM_P_PSM_CNTXT_3_LSB6_ADDR A:0x6791d900
y.create.l HWIO_IPA_BAM_P_PSM_CNTXT_3_LSB7_ADDR A:0x6791e900
y.create.l HWIO_IPA_BAM_P_PSM_CNTXT_3_LSB8_ADDR A:0x6791f900
y.create.l HWIO_IPA_BAM_P_PSM_CNTXT_3_LSB9_ADDR A:0x67920900
y.create.l HWIO_IPA_BAM_P_PSM_CNTXT_3_MSB0_ADDR A:0x67917904
y.create.l HWIO_IPA_BAM_P_PSM_CNTXT_3_MSB1_ADDR A:0x67918904
y.create.l HWIO_IPA_BAM_P_PSM_CNTXT_3_MSB2_ADDR A:0x67919904
y.create.l HWIO_IPA_BAM_P_PSM_CNTXT_3_MSB3_ADDR A:0x6791a904
y.create.l HWIO_IPA_BAM_P_PSM_CNTXT_3_MSB4_ADDR A:0x6791b904
y.create.l HWIO_IPA_BAM_P_PSM_CNTXT_3_MSB5_ADDR A:0x6791c904
y.create.l HWIO_IPA_BAM_P_PSM_CNTXT_3_MSB6_ADDR A:0x6791d904
y.create.l HWIO_IPA_BAM_P_PSM_CNTXT_3_MSB7_ADDR A:0x6791e904
y.create.l HWIO_IPA_BAM_P_PSM_CNTXT_3_MSB8_ADDR A:0x6791f904
y.create.l HWIO_IPA_BAM_P_PSM_CNTXT_3_MSB9_ADDR A:0x67920904
y.create.l HWIO_IPA_BAM_P_DESC_FIFO_ADDR_LSB0_ADDR A:0x67917910
y.create.l HWIO_IPA_BAM_P_DESC_FIFO_ADDR_LSB1_ADDR A:0x67918910
y.create.l HWIO_IPA_BAM_P_DESC_FIFO_ADDR_LSB2_ADDR A:0x67919910
y.create.l HWIO_IPA_BAM_P_DESC_FIFO_ADDR_LSB3_ADDR A:0x6791a910
y.create.l HWIO_IPA_BAM_P_DESC_FIFO_ADDR_LSB4_ADDR A:0x6791b910
y.create.l HWIO_IPA_BAM_P_DESC_FIFO_ADDR_LSB5_ADDR A:0x6791c910
y.create.l HWIO_IPA_BAM_P_DESC_FIFO_ADDR_LSB6_ADDR A:0x6791d910
y.create.l HWIO_IPA_BAM_P_DESC_FIFO_ADDR_LSB7_ADDR A:0x6791e910
y.create.l HWIO_IPA_BAM_P_DESC_FIFO_ADDR_LSB8_ADDR A:0x6791f910
y.create.l HWIO_IPA_BAM_P_DESC_FIFO_ADDR_LSB9_ADDR A:0x67920910
y.create.l HWIO_IPA_BAM_P_DESC_FIFO_ADDR_MSB0_ADDR A:0x67917914
y.create.l HWIO_IPA_BAM_P_DESC_FIFO_ADDR_MSB1_ADDR A:0x67918914
y.create.l HWIO_IPA_BAM_P_DESC_FIFO_ADDR_MSB2_ADDR A:0x67919914
y.create.l HWIO_IPA_BAM_P_DESC_FIFO_ADDR_MSB3_ADDR A:0x6791a914
y.create.l HWIO_IPA_BAM_P_DESC_FIFO_ADDR_MSB4_ADDR A:0x6791b914
y.create.l HWIO_IPA_BAM_P_DESC_FIFO_ADDR_MSB5_ADDR A:0x6791c914
y.create.l HWIO_IPA_BAM_P_DESC_FIFO_ADDR_MSB6_ADDR A:0x6791d914
y.create.l HWIO_IPA_BAM_P_DESC_FIFO_ADDR_MSB7_ADDR A:0x6791e914
y.create.l HWIO_IPA_BAM_P_DESC_FIFO_ADDR_MSB8_ADDR A:0x6791f914
y.create.l HWIO_IPA_BAM_P_DESC_FIFO_ADDR_MSB9_ADDR A:0x67920914
y.create.l HWIO_IPA_BAM_P_DATA_FIFO_ADDR_LSB0_ADDR A:0x67917920
y.create.l HWIO_IPA_BAM_P_DATA_FIFO_ADDR_LSB1_ADDR A:0x67918920
y.create.l HWIO_IPA_BAM_P_DATA_FIFO_ADDR_LSB2_ADDR A:0x67919920
y.create.l HWIO_IPA_BAM_P_DATA_FIFO_ADDR_LSB3_ADDR A:0x6791a920
y.create.l HWIO_IPA_BAM_P_DATA_FIFO_ADDR_LSB4_ADDR A:0x6791b920
y.create.l HWIO_IPA_BAM_P_DATA_FIFO_ADDR_LSB5_ADDR A:0x6791c920
y.create.l HWIO_IPA_BAM_P_DATA_FIFO_ADDR_LSB6_ADDR A:0x6791d920
y.create.l HWIO_IPA_BAM_P_DATA_FIFO_ADDR_LSB7_ADDR A:0x6791e920
y.create.l HWIO_IPA_BAM_P_DATA_FIFO_ADDR_LSB8_ADDR A:0x6791f920
y.create.l HWIO_IPA_BAM_P_DATA_FIFO_ADDR_LSB9_ADDR A:0x67920920
y.create.l HWIO_IPA_BAM_P_DATA_FIFO_ADDR_MSB0_ADDR A:0x67917924
y.create.l HWIO_IPA_BAM_P_DATA_FIFO_ADDR_MSB1_ADDR A:0x67918924
y.create.l HWIO_IPA_BAM_P_DATA_FIFO_ADDR_MSB2_ADDR A:0x67919924
y.create.l HWIO_IPA_BAM_P_DATA_FIFO_ADDR_MSB3_ADDR A:0x6791a924
y.create.l HWIO_IPA_BAM_P_DATA_FIFO_ADDR_MSB4_ADDR A:0x6791b924
y.create.l HWIO_IPA_BAM_P_DATA_FIFO_ADDR_MSB5_ADDR A:0x6791c924
y.create.l HWIO_IPA_BAM_P_DATA_FIFO_ADDR_MSB6_ADDR A:0x6791d924
y.create.l HWIO_IPA_BAM_P_DATA_FIFO_ADDR_MSB7_ADDR A:0x6791e924
y.create.l HWIO_IPA_BAM_P_DATA_FIFO_ADDR_MSB8_ADDR A:0x6791f924
y.create.l HWIO_IPA_BAM_P_DATA_FIFO_ADDR_MSB9_ADDR A:0x67920924
y.create.l HWIO_IPA_BAM_P_EVNT_DEST_ADDR_LSB0_ADDR A:0x67917930
y.create.l HWIO_IPA_BAM_P_EVNT_DEST_ADDR_LSB1_ADDR A:0x67918930
y.create.l HWIO_IPA_BAM_P_EVNT_DEST_ADDR_LSB2_ADDR A:0x67919930
y.create.l HWIO_IPA_BAM_P_EVNT_DEST_ADDR_LSB3_ADDR A:0x6791a930
y.create.l HWIO_IPA_BAM_P_EVNT_DEST_ADDR_LSB4_ADDR A:0x6791b930
y.create.l HWIO_IPA_BAM_P_EVNT_DEST_ADDR_LSB5_ADDR A:0x6791c930
y.create.l HWIO_IPA_BAM_P_EVNT_DEST_ADDR_LSB6_ADDR A:0x6791d930
y.create.l HWIO_IPA_BAM_P_EVNT_DEST_ADDR_LSB7_ADDR A:0x6791e930
y.create.l HWIO_IPA_BAM_P_EVNT_DEST_ADDR_LSB8_ADDR A:0x6791f930
y.create.l HWIO_IPA_BAM_P_EVNT_DEST_ADDR_LSB9_ADDR A:0x67920930
y.create.l HWIO_IPA_BAM_P_EVNT_DEST_ADDR_MSB0_ADDR A:0x67917934
y.create.l HWIO_IPA_BAM_P_EVNT_DEST_ADDR_MSB1_ADDR A:0x67918934
y.create.l HWIO_IPA_BAM_P_EVNT_DEST_ADDR_MSB2_ADDR A:0x67919934
y.create.l HWIO_IPA_BAM_P_EVNT_DEST_ADDR_MSB3_ADDR A:0x6791a934
y.create.l HWIO_IPA_BAM_P_EVNT_DEST_ADDR_MSB4_ADDR A:0x6791b934
y.create.l HWIO_IPA_BAM_P_EVNT_DEST_ADDR_MSB5_ADDR A:0x6791c934
y.create.l HWIO_IPA_BAM_P_EVNT_DEST_ADDR_MSB6_ADDR A:0x6791d934
y.create.l HWIO_IPA_BAM_P_EVNT_DEST_ADDR_MSB7_ADDR A:0x6791e934
y.create.l HWIO_IPA_BAM_P_EVNT_DEST_ADDR_MSB8_ADDR A:0x6791f934
y.create.l HWIO_IPA_BAM_P_EVNT_DEST_ADDR_MSB9_ADDR A:0x67920934
y.create.l HWIO_IPA_XPU_SCR_ADDR A:0x67902000
y.create.l HWIO_IPA_XPU_SWDR_ADDR A:0x67902004
y.create.l HWIO_IPA_XPU_SEAR0_ADDR A:0x67902040
y.create.l HWIO_IPA_XPU_SESR_ADDR A:0x67902048
y.create.l HWIO_IPA_XPU_SESRRESTORE_ADDR A:0x6790204c
y.create.l HWIO_IPA_XPU_SESYNR0_ADDR A:0x67902050
y.create.l HWIO_IPA_XPU_SESYNR1_ADDR A:0x67902054
y.create.l HWIO_IPA_XPU_SESYNR2_ADDR A:0x67902058
y.create.l HWIO_IPA_XPU_MCR_ADDR A:0x67902100
y.create.l HWIO_IPA_XPU_MEAR0_ADDR A:0x67902140
y.create.l HWIO_IPA_XPU_MESR_ADDR A:0x67902148
y.create.l HWIO_IPA_XPU_MESRRESTORE_ADDR A:0x6790214c
y.create.l HWIO_IPA_XPU_MESYNR0_ADDR A:0x67902150
y.create.l HWIO_IPA_XPU_MESYNR1_ADDR A:0x67902154
y.create.l HWIO_IPA_XPU_MESYNR2_ADDR A:0x67902158
y.create.l HWIO_IPA_XPU_CR_ADDR A:0x67902080
y.create.l HWIO_IPA_XPU_RPU_ACR0_ADDR A:0x679020a0
y.create.l HWIO_IPA_XPU_EAR0_ADDR A:0x679020c0
y.create.l HWIO_IPA_XPU_ESR_ADDR A:0x679020c8
y.create.l HWIO_IPA_XPU_ESRRESTORE_ADDR A:0x679020cc
y.create.l HWIO_IPA_XPU_ESYNR0_ADDR A:0x679020d0
y.create.l HWIO_IPA_XPU_ESYNR1_ADDR A:0x679020d4
y.create.l HWIO_IPA_XPU_ESYNR2_ADDR A:0x679020d8
y.create.l HWIO_IPA_XPU_IDR0_ADDR A:0x67902074
y.create.l HWIO_IPA_XPU_IDR1_ADDR A:0x67902078
y.create.l HWIO_IPA_XPU_REV_ADDR A:0x6790207c
y.create.l HWIO_IPA_XPU_RG0_RACR0_ADDR A:0x67902200
y.create.l HWIO_IPA_XPU_RG1_RACR0_ADDR A:0x67902280
y.create.l HWIO_IPA_XPU_RG2_RACR0_ADDR A:0x67902300
y.create.l HWIO_IPA_XPU_RG3_RACR0_ADDR A:0x67902380
y.create.l HWIO_IPA_XPU_RG4_RACR0_ADDR A:0x67902400
y.create.l HWIO_IPA_XPU_RG5_RACR0_ADDR A:0x67902480
y.create.l HWIO_IPA_XPU_RG6_RACR0_ADDR A:0x67902500
y.create.l HWIO_IPA_XPU_RG7_RACR0_ADDR A:0x67902580
y.create.l HWIO_IPA_XPU_RG8_RACR0_ADDR A:0x67902600
y.create.l HWIO_IPA_XPU_RG9_RACR0_ADDR A:0x67902680
y.create.l HWIO_IPA_XPU_RG0_SCR_ADDR A:0x67902250
y.create.l HWIO_IPA_XPU_RG1_SCR_ADDR A:0x679022d0
y.create.l HWIO_IPA_XPU_RG2_SCR_ADDR A:0x67902350
y.create.l HWIO_IPA_XPU_RG3_SCR_ADDR A:0x679023d0
y.create.l HWIO_IPA_XPU_RG4_SCR_ADDR A:0x67902450
y.create.l HWIO_IPA_XPU_RG5_SCR_ADDR A:0x679024d0
y.create.l HWIO_IPA_XPU_RG6_SCR_ADDR A:0x67902550
y.create.l HWIO_IPA_XPU_RG7_SCR_ADDR A:0x679025d0
y.create.l HWIO_IPA_XPU_RG8_SCR_ADDR A:0x67902650
y.create.l HWIO_IPA_XPU_RG9_SCR_ADDR A:0x679026d0
y.create.l HWIO_IPA_XPU_RG0_MCR_ADDR A:0x67902254
y.create.l HWIO_IPA_XPU_RG1_MCR_ADDR A:0x679022d4
y.create.l HWIO_IPA_XPU_RG2_MCR_ADDR A:0x67902354
y.create.l HWIO_IPA_XPU_RG3_MCR_ADDR A:0x679023d4
y.create.l HWIO_IPA_XPU_RG4_MCR_ADDR A:0x67902454
y.create.l HWIO_IPA_XPU_RG5_MCR_ADDR A:0x679024d4
y.create.l HWIO_IPA_XPU_RG6_MCR_ADDR A:0x67902554
y.create.l HWIO_IPA_XPU_RG7_MCR_ADDR A:0x679025d4
y.create.l HWIO_IPA_XPU_RG8_MCR_ADDR A:0x67902654
y.create.l HWIO_IPA_XPU_RG9_MCR_ADDR A:0x679026d4
y.create.l HWIO_IPA_IPA_VMIDMT_SCR0_ADDR A:0x67930000
y.create.l HWIO_IPA_IPA_VMIDMT_SCR1_ADDR A:0x67930004
y.create.l HWIO_IPA_IPA_VMIDMT_SCR2_ADDR A:0x67930008
y.create.l HWIO_IPA_IPA_VMIDMT_SACR_ADDR A:0x67930010
y.create.l HWIO_IPA_IPA_VMIDMT_SIDR0_ADDR A:0x67930020
y.create.l HWIO_IPA_IPA_VMIDMT_SIDR1_ADDR A:0x67930024
y.create.l HWIO_IPA_IPA_VMIDMT_SIDR2_ADDR A:0x67930028
y.create.l HWIO_IPA_IPA_VMIDMT_SIDR4_ADDR A:0x67930030
y.create.l HWIO_IPA_IPA_VMIDMT_SIDR5_ADDR A:0x67930034
y.create.l HWIO_IPA_IPA_VMIDMT_SIDR7_ADDR A:0x6793003c
y.create.l HWIO_IPA_IPA_VMIDMT_SGFAR0_ADDR A:0x67930040
y.create.l HWIO_IPA_IPA_VMIDMT_SGFSR_ADDR A:0x67930048
y.create.l HWIO_IPA_IPA_VMIDMT_SGFSRRESTORE_ADDR A:0x6793004c
y.create.l HWIO_IPA_IPA_VMIDMT_SGFSYNDR0_ADDR A:0x67930050
y.create.l HWIO_IPA_IPA_VMIDMT_SGFSYNDR1_ADDR A:0x67930054
y.create.l HWIO_IPA_IPA_VMIDMT_SGFSYNDR2_ADDR A:0x67930058
y.create.l HWIO_IPA_IPA_VMIDMT_VMIDMTSCR0_ADDR A:0x67930090
y.create.l HWIO_IPA_IPA_VMIDMT_CR0_ADDR A:0x67930000
y.create.l HWIO_IPA_IPA_VMIDMT_CR2_ADDR A:0x67930008
y.create.l HWIO_IPA_IPA_VMIDMT_ACR_ADDR A:0x67930010
y.create.l HWIO_IPA_IPA_VMIDMT_IDR0_ADDR A:0x67930020
y.create.l HWIO_IPA_IPA_VMIDMT_IDR1_ADDR A:0x67930024
y.create.l HWIO_IPA_IPA_VMIDMT_IDR2_ADDR A:0x67930028
y.create.l HWIO_IPA_IPA_VMIDMT_IDR4_ADDR A:0x67930030
y.create.l HWIO_IPA_IPA_VMIDMT_IDR5_ADDR A:0x67930034
y.create.l HWIO_IPA_IPA_VMIDMT_IDR7_ADDR A:0x6793003c
y.create.l HWIO_IPA_IPA_VMIDMT_GFAR0_ADDR A:0x67930040
y.create.l HWIO_IPA_IPA_VMIDMT_GFSR_ADDR A:0x67930048
y.create.l HWIO_IPA_IPA_VMIDMT_GFSRRESTORE_ADDR A:0x6793004c
y.create.l HWIO_IPA_IPA_VMIDMT_GFSYNDR0_ADDR A:0x67930050
y.create.l HWIO_IPA_IPA_VMIDMT_GFSYNDR1_ADDR A:0x67930054
y.create.l HWIO_IPA_IPA_VMIDMT_GFSYNDR2_ADDR A:0x67930058
y.create.l HWIO_IPA_IPA_VMIDMT_VMIDMTCR0_ADDR A:0x67930090
y.create.l HWIO_IPA_IPA_VMIDMT_VMIDMTACR_ADDR A:0x6793009c
y.create.l HWIO_IPA_IPA_VMIDMT_NSCR0_ADDR A:0x67930400
y.create.l HWIO_IPA_IPA_VMIDMT_NSCR2_ADDR A:0x67930408
y.create.l HWIO_IPA_IPA_VMIDMT_NSACR_ADDR A:0x67930410
y.create.l HWIO_IPA_IPA_VMIDMT_NSGFAR0_ADDR A:0x67930440
y.create.l HWIO_IPA_IPA_VMIDMT_NSGFSR_ADDR A:0x67930448
y.create.l HWIO_IPA_IPA_VMIDMT_NSGFSRRESTORE_ADDR A:0x6793044c
y.create.l HWIO_IPA_IPA_VMIDMT_NSGFSYNDR0_ADDR A:0x67930450
y.create.l HWIO_IPA_IPA_VMIDMT_NSGFSYNDR1_ADDR A:0x67930454
y.create.l HWIO_IPA_IPA_VMIDMT_NSGFSYNDR2_ADDR A:0x67930458
y.create.l HWIO_IPA_IPA_VMIDMT_NSVMIDMTCR0_ADDR A:0x67930490
y.create.l HWIO_IPA_IPA_VMIDMT_SSDR0_ADDR A:0x67930080
y.create.l HWIO_IPA_IPA_VMIDMT_MSDR0_ADDR A:0x67930480
y.create.l HWIO_IPA_IPA_VMIDMT_MCR_ADDR A:0x67930494
y.create.l HWIO_IPA_IPA_VMIDMT_S2VR0_ADDR A:0x67930c00
y.create.l HWIO_IPA_IPA_VMIDMT_S2VR1_ADDR A:0x67930c04
y.create.l HWIO_IPA_IPA_VMIDMT_S2VR2_ADDR A:0x67930c08
y.create.l HWIO_IPA_IPA_VMIDMT_S2VR3_ADDR A:0x67930c0c
y.create.l HWIO_IPA_IPA_VMIDMT_S2VR4_ADDR A:0x67930c10
y.create.l HWIO_IPA_IPA_VMIDMT_S2VR5_ADDR A:0x67930c14
y.create.l HWIO_IPA_IPA_VMIDMT_S2VR6_ADDR A:0x67930c18
y.create.l HWIO_IPA_IPA_VMIDMT_S2VR7_ADDR A:0x67930c1c
y.create.l HWIO_IPA_IPA_VMIDMT_S2VR8_ADDR A:0x67930c20
y.create.l HWIO_IPA_IPA_VMIDMT_S2VR9_ADDR A:0x67930c24
y.create.l HWIO_IPA_IPA_VMIDMT_AS2VR0_ADDR A:0x67930e00
y.create.l HWIO_IPA_IPA_VMIDMT_AS2VR1_ADDR A:0x67930e04
y.create.l HWIO_IPA_IPA_VMIDMT_AS2VR2_ADDR A:0x67930e08
y.create.l HWIO_IPA_IPA_VMIDMT_AS2VR3_ADDR A:0x67930e0c
y.create.l HWIO_IPA_IPA_VMIDMT_AS2VR4_ADDR A:0x67930e10
y.create.l HWIO_IPA_IPA_VMIDMT_AS2VR5_ADDR A:0x67930e14
y.create.l HWIO_IPA_IPA_VMIDMT_AS2VR6_ADDR A:0x67930e18
y.create.l HWIO_IPA_IPA_VMIDMT_AS2VR7_ADDR A:0x67930e1c
y.create.l HWIO_IPA_IPA_VMIDMT_AS2VR8_ADDR A:0x67930e20
y.create.l HWIO_IPA_IPA_VMIDMT_AS2VR9_ADDR A:0x67930e24
y.create.l HWIO_IPA_IPA_VMIDMT_SMR0_ADDR A:0x67930800
y.create.l HWIO_IPA_IPA_VMIDMT_SMR1_ADDR A:0x67930804
y.create.l HWIO_IPA_IPA_VMIDMT_SMR2_ADDR A:0x67930808
y.create.l HWIO_IPA_IPA_VMIDMT_SMR3_ADDR A:0x6793080c
y.create.l HWIO_IPA_IPA_VMIDMT_SMR4_ADDR A:0x67930810
y.create.l HWIO_IPA_IPA_VMIDMT_SMR5_ADDR A:0x67930814
y.create.l HWIO_IPA_IPA_VMIDMT_SMR6_ADDR A:0x67930818
y.create.l HWIO_IPA_IPA_VMIDMT_SMR7_ADDR A:0x6793081c
y.create.l HWIO_IPA_IPA_VMIDMT_SMR8_ADDR A:0x67930820
y.create.l HWIO_IPA_IPA_VMIDMT_SMR9_ADDR A:0x67930824
y.create.l HWIO_IPA_IPA_IRQ_SRCS_EE_0_ADDR A:0x67941000
y.create.l HWIO_IPA_IPA_IRQ_SRCS_EE_1_ADDR A:0x67942000
y.create.l HWIO_IPA_IPA_IRQ_SRCS_EE_2_ADDR A:0x67943000
y.create.l HWIO_IPA_IPA_IRQ_SRCS_EE_3_ADDR A:0x67944000
y.create.l HWIO_IPA_IPA_IRQ_SRCS_MSK_EE_0_ADDR A:0x67941004
y.create.l HWIO_IPA_IPA_IRQ_SRCS_MSK_EE_1_ADDR A:0x67942004
y.create.l HWIO_IPA_IPA_IRQ_SRCS_MSK_EE_2_ADDR A:0x67943004
y.create.l HWIO_IPA_IPA_IRQ_SRCS_MSK_EE_3_ADDR A:0x67944004
y.create.l HWIO_IPA_IPA_IRQ_STTS_EE_0_ADDR A:0x67941008
y.create.l HWIO_IPA_IPA_IRQ_STTS_EE_1_ADDR A:0x67942008
y.create.l HWIO_IPA_IPA_IRQ_STTS_EE_2_ADDR A:0x67943008
y.create.l HWIO_IPA_IPA_IRQ_STTS_EE_3_ADDR A:0x67944008
y.create.l HWIO_IPA_IPA_IRQ_EN_EE_0_ADDR A:0x6794100c
y.create.l HWIO_IPA_IPA_IRQ_EN_EE_1_ADDR A:0x6794200c
y.create.l HWIO_IPA_IPA_IRQ_EN_EE_2_ADDR A:0x6794300c
y.create.l HWIO_IPA_IPA_IRQ_EN_EE_3_ADDR A:0x6794400c
y.create.l HWIO_IPA_IPA_IRQ_CLR_EE_0_ADDR A:0x67941010
y.create.l HWIO_IPA_IPA_IRQ_CLR_EE_1_ADDR A:0x67942010
y.create.l HWIO_IPA_IPA_IRQ_CLR_EE_2_ADDR A:0x67943010
y.create.l HWIO_IPA_IPA_IRQ_CLR_EE_3_ADDR A:0x67944010
y.create.l HWIO_IPA_IPA_IRQ_EOT_COAL_CFG_EE_0_ADDR A:0x67941014
y.create.l HWIO_IPA_IPA_IRQ_EOT_COAL_CFG_EE_1_ADDR A:0x67942014
y.create.l HWIO_IPA_IPA_IRQ_EOT_COAL_CFG_EE_2_ADDR A:0x67943014
y.create.l HWIO_IPA_IPA_IRQ_EOT_COAL_CFG_EE_3_ADDR A:0x67944014
y.create.l HWIO_IPA_IPA_SNOC_FEC_EE_0_ADDR A:0x67941018
y.create.l HWIO_IPA_IPA_SNOC_FEC_EE_1_ADDR A:0x67942018
y.create.l HWIO_IPA_IPA_SNOC_FEC_EE_2_ADDR A:0x67943018
y.create.l HWIO_IPA_IPA_SNOC_FEC_EE_3_ADDR A:0x67944018
y.create.l HWIO_IPA_IPA_SET_UC_IRQ_EE_0_ADDR A:0x67944028
y.create.l HWIO_IPA_IPA_SET_UC_IRQ_EE_1_ADDR A:0x6794402c
y.create.l HWIO_IPA_IPA_SET_UC_IRQ_EE_2_ADDR A:0x67944030
y.create.l HWIO_IPA_IPA_SET_UC_IRQ_EE_3_ADDR A:0x67944034
y.create.l HWIO_IPA_IPA_SET_UC_IRQ_ALL_EES_ADDR A:0x67944038
y.create.l HWIO_IPA_IPA_IRQ_EE_UC_0_ADDR A:0x6794101c
y.create.l HWIO_IPA_IPA_IRQ_EE_UC_1_ADDR A:0x6794201c
y.create.l HWIO_IPA_IPA_IRQ_EE_UC_2_ADDR A:0x6794301c
y.create.l HWIO_IPA_IPA_IRQ_EE_UC_3_ADDR A:0x6794401c
y.create.l HWIO_IPA_IPA_FEC_ADDR_EE_0_ADDR A:0x67941020
y.create.l HWIO_IPA_IPA_FEC_ADDR_EE_1_ADDR A:0x67942020
y.create.l HWIO_IPA_IPA_FEC_ADDR_EE_2_ADDR A:0x67943020
y.create.l HWIO_IPA_IPA_FEC_ADDR_EE_3_ADDR A:0x67944020
y.create.l HWIO_IPA_IPA_FEC_ATTR_EE_0_ADDR A:0x67941024
y.create.l HWIO_IPA_IPA_FEC_ATTR_EE_1_ADDR A:0x67942024
y.create.l HWIO_IPA_IPA_FEC_ATTR_EE_2_ADDR A:0x67943024
y.create.l HWIO_IPA_IPA_FEC_ATTR_EE_3_ADDR A:0x67944024
y.create.l HWIO_IPA_IPA_SUSPEND_IRQ_INFO_EE_0_ADDR A:0x67941098
y.create.l HWIO_IPA_IPA_SUSPEND_IRQ_INFO_EE_1_ADDR A:0x67942098
y.create.l HWIO_IPA_IPA_SUSPEND_IRQ_INFO_EE_2_ADDR A:0x67943098
y.create.l HWIO_IPA_IPA_SUSPEND_IRQ_INFO_EE_3_ADDR A:0x67944098
y.create.l HWIO_IPA_IPA_HOLB_DROP_IRQ_INFO_EE_0_ADDR A:0x6794109c
y.create.l HWIO_IPA_IPA_HOLB_DROP_IRQ_INFO_EE_1_ADDR A:0x6794209c
y.create.l HWIO_IPA_IPA_HOLB_DROP_IRQ_INFO_EE_2_ADDR A:0x6794309c
y.create.l HWIO_IPA_IPA_HOLB_DROP_IRQ_INFO_EE_3_ADDR A:0x6794409c
y.create.l HWIO_IPA_IPA_COMP_HW_VERSION_ADDR A:0x67940030
y.create.l HWIO_IPA_IPA_VERSION_ADDR A:0x67940034
y.create.l HWIO_IPA_IPA_COMP_CFG_ADDR A:0x67940038
y.create.l HWIO_IPA_IPA_COMP_SW_RESET_ADDR A:0x6794003c
y.create.l HWIO_IPA_IPA_CLKON_CFG_ADDR A:0x67940040
y.create.l HWIO_IPA_IPA_ROUTE_ADDR A:0x67940044
y.create.l HWIO_IPA_IPA_FILTER_ADDR A:0x67940048
y.create.l HWIO_IPA_IPA_MASTER_PRIORITY_ADDR A:0x6794004c
y.create.l HWIO_IPA_IPA_SHARED_MEM_SIZE_ADDR A:0x67940050
y.create.l HWIO_IPA_IPA_NAT_TIMER_ADDR A:0x67940054
y.create.l HWIO_IPA_IPA_NAT_TIMER_RESET_ADDR A:0x67940058
y.create.l HWIO_IPA_IPA_TAG_TIMER_ADDR A:0x6794005c
y.create.l HWIO_IPA_IPA_QCNCM_ADDR A:0x67940060
y.create.l HWIO_IPA_IPA_SINGLE_NDP_MODE_ADDR A:0x67940064
y.create.l HWIO_IPA_IPA_FRAG_RULES_CLR_ADDR A:0x67940068
y.create.l HWIO_IPA_IPA_PROC_IPH_CFG_ADDR A:0x6794006c
y.create.l HWIO_IPA_IPA_QSB_MAX_WRITES_ADDR A:0x67940520
y.create.l HWIO_IPA_IPA_QSB_MAX_READS_ADDR A:0x67940524
y.create.l HWIO_IPA_IPA_QSB_READ_CFG_ADDR A:0x67940528
y.create.l HWIO_IPA_IPA_STATE_ADDR A:0x6794052c
y.create.l HWIO_IPA_IPA_STATE_RX_ACTIVE_ADDR A:0x67940530
y.create.l HWIO_IPA_IPA_STATE_TX_ACTIVE_ADDR A:0x67940534
y.create.l HWIO_IPA_IPA_STATE_AGGR_ACTIVE_ADDR A:0x67940538
y.create.l HWIO_IPA_IPA_YELLOW_MARKER_BELOW_ADDR A:0x6794053c
y.create.l HWIO_IPA_IPA_YELLOW_MARKER_BELOW_EN_ADDR A:0x67940540
y.create.l HWIO_IPA_IPA_YELLOW_MARKER_BELOW_CLR_ADDR A:0x67940544
y.create.l HWIO_IPA_IPA_RED_MARKER_BELOW_ADDR A:0x67940548
y.create.l HWIO_IPA_IPA_RED_MARKER_BELOW_EN_ADDR A:0x6794054c
y.create.l HWIO_IPA_IPA_RED_MARKER_BELOW_CLR_ADDR A:0x67940550
y.create.l HWIO_IPA_IPA_YELLOW_MARKER_CFG_ADDR A:0x67940554
y.create.l HWIO_IPA_IPA_RED_MARKER_CFG_ADDR A:0x67940558
y.create.l HWIO_IPA_IPA_YELLOW_MARKER_SHADOW_ADDR A:0x6794055c
y.create.l HWIO_IPA_IPA_RED_MARKER_SHADOW_ADDR A:0x67940560
y.create.l HWIO_IPA_IPA_IPV4_FILTER_INIT_VALUES_0_ADDR A:0x67940564
y.create.l HWIO_IPA_IPA_IPV4_FILTER_INIT_VALUES_1_ADDR A:0x67940568
y.create.l HWIO_IPA_IPA_IPV6_FILTER_INIT_VALUES_0_ADDR A:0x6794056c
y.create.l HWIO_IPA_IPA_IPV6_FILTER_INIT_VALUES_1_ADDR A:0x67940570
y.create.l HWIO_IPA_IPA_IPV4_NAT_INIT_VALUES_0_ADDR A:0x67940574
y.create.l HWIO_IPA_IPA_IPV4_NAT_INIT_VALUES_1_ADDR A:0x67940578
y.create.l HWIO_IPA_IPA_IPV4_NAT_INIT_VALUES_2_ADDR A:0x6794057c
y.create.l HWIO_IPA_IPA_IPV4_NAT_INIT_VALUES_3_ADDR A:0x67940580
y.create.l HWIO_IPA_IPA_IPV4_NAT_INIT_VALUES_4_ADDR A:0x67940584
y.create.l HWIO_IPA_IPA_IPV4_NAT_INIT_VALUES_5_ADDR A:0x67940588
y.create.l HWIO_IPA_IPA_IPV4_ROUTE_INIT_VALUES_0_ADDR A:0x6794058c
y.create.l HWIO_IPA_IPA_IPV4_ROUTE_INIT_VALUES_1_ADDR A:0x67940590
y.create.l HWIO_IPA_IPA_IPV6_ROUTE_INIT_VALUES_0_ADDR A:0x67940594
y.create.l HWIO_IPA_IPA_IPV6_ROUTE_INIT_VALUES_1_ADDR A:0x67940598
y.create.l HWIO_IPA_IPA_HDR_INIT_LOCAL_VALUES_0_ADDR A:0x6794059c
y.create.l HWIO_IPA_IPA_HDR_INIT_LOCAL_VALUES_1_ADDR A:0x679405a4
y.create.l HWIO_IPA_IPA_HDR_INIT_SYSTEM_VALUES_ADDR A:0x679405a8
y.create.l HWIO_IPA_IPA_IMM_CMD_ACCESS_PIPE_VALUES_ADDR A:0x679405ac
y.create.l HWIO_IPA_IPA_BCR_ADDR A:0x679405b0
y.create.l HWIO_IPA_IPA_MVS_ADDR A:0x679405b4
y.create.l HWIO_IPA_IPA_YELLOW_MARKER_ABOVE_ADDR A:0x679405b8
y.create.l HWIO_IPA_IPA_YELLOW_MARKER_ABOVE_EN_ADDR A:0x679405bc
y.create.l HWIO_IPA_IPA_YELLOW_MARKER_ABOVE_CLR_ADDR A:0x679405c0
y.create.l HWIO_IPA_IPA_RED_MARKER_ABOVE_ADDR A:0x679405c4
y.create.l HWIO_IPA_IPA_RED_MARKER_ABOVE_EN_ADDR A:0x679405c8
y.create.l HWIO_IPA_IPA_RED_MARKER_ABOVE_CLR_ADDR A:0x679405cc
y.create.l HWIO_IPA_IPA_FRAG_VALUES_ADDR A:0x679405d0
y.create.l HWIO_IPA_IPA_BAM_ACTIVATED_PORTS_ADDR A:0x679405d4
y.create.l HWIO_IPA_IPA_SYS_PKT_PROC_CNTXT_BASE_ADDR A:0x679405d8
y.create.l HWIO_IPA_IPA_LOCAL_PKT_PROC_CNTXT_BASE_ADDR A:0x679405e0
y.create.l HWIO_IPA_IPA_SCND_FRAG_VALUES_ADDR A:0x679405e4
y.create.l HWIO_IPA_IPA_COUNTER_CFG_ADDR A:0x679405e8
y.create.l HWIO_IPA_IPA_UCP_RESUME_ADDR A:0x679405ec
y.create.l HWIO_IPA_IPA_PROC_UCP_CFG_ADDR A:0x679405f0
y.create.l HWIO_IPA_IPA_UC_PKT_PROCESS_BASE_ADDR_0_ADDR A:0x679405f4
y.create.l HWIO_IPA_IPA_UC_PKT_PROCESS_BASE_ADDR_1_ADDR A:0x679405f8
y.create.l HWIO_IPA_IPA_PROC_PKT_SYNC_PARAMS_0_SLOT_0_ADDR A:0x67940800
y.create.l HWIO_IPA_IPA_PROC_PKT_SYNC_PARAMS_0_SLOT_1_ADDR A:0x67940840
y.create.l HWIO_IPA_IPA_PROC_PKT_SYNC_PARAMS_0_SLOT_2_ADDR A:0x67940880
y.create.l HWIO_IPA_IPA_PROC_PKT_SYNC_PARAMS_0_SLOT_3_ADDR A:0x679408c0
y.create.l HWIO_IPA_IPA_PROC_PKT_SYNC_PARAMS_0_SLOT_4_ADDR A:0x67940900
y.create.l HWIO_IPA_IPA_PROC_PKT_SYNC_PARAMS_1_SLOT_0_ADDR A:0x67940804
y.create.l HWIO_IPA_IPA_PROC_PKT_SYNC_PARAMS_1_SLOT_1_ADDR A:0x67940844
y.create.l HWIO_IPA_IPA_PROC_PKT_SYNC_PARAMS_1_SLOT_2_ADDR A:0x67940884
y.create.l HWIO_IPA_IPA_PROC_PKT_SYNC_PARAMS_1_SLOT_3_ADDR A:0x679408c4
y.create.l HWIO_IPA_IPA_PROC_PKT_SYNC_PARAMS_1_SLOT_4_ADDR A:0x67940904
y.create.l HWIO_IPA_IPA_PROC_PKT_SYNC_PARAMS_2_SLOT_0_ADDR A:0x67940808
y.create.l HWIO_IPA_IPA_PROC_PKT_SYNC_PARAMS_2_SLOT_1_ADDR A:0x67940848
y.create.l HWIO_IPA_IPA_PROC_PKT_SYNC_PARAMS_2_SLOT_2_ADDR A:0x67940888
y.create.l HWIO_IPA_IPA_PROC_PKT_SYNC_PARAMS_2_SLOT_3_ADDR A:0x679408c8
y.create.l HWIO_IPA_IPA_PROC_PKT_SYNC_PARAMS_2_SLOT_4_ADDR A:0x67940908
y.create.l HWIO_IPA_IPA_PROC_PKT_SYNC_PARAMS_3_SLOT_0_ADDR A:0x6794080c
y.create.l HWIO_IPA_IPA_PROC_PKT_SYNC_PARAMS_3_SLOT_1_ADDR A:0x6794084c
y.create.l HWIO_IPA_IPA_PROC_PKT_SYNC_PARAMS_3_SLOT_2_ADDR A:0x6794088c
y.create.l HWIO_IPA_IPA_PROC_PKT_SYNC_PARAMS_3_SLOT_3_ADDR A:0x679408cc
y.create.l HWIO_IPA_IPA_PROC_PKT_SYNC_PARAMS_3_SLOT_4_ADDR A:0x6794090c
y.create.l HWIO_IPA_IPA_PROC_PKT_SYNC_PARAMS_4_SLOT_0_ADDR A:0x67940810
y.create.l HWIO_IPA_IPA_PROC_PKT_SYNC_PARAMS_4_SLOT_1_ADDR A:0x67940850
y.create.l HWIO_IPA_IPA_PROC_PKT_SYNC_PARAMS_4_SLOT_2_ADDR A:0x67940890
y.create.l HWIO_IPA_IPA_PROC_PKT_SYNC_PARAMS_4_SLOT_3_ADDR A:0x679408d0
y.create.l HWIO_IPA_IPA_PROC_PKT_SYNC_PARAMS_4_SLOT_4_ADDR A:0x67940910
y.create.l HWIO_IPA_IPA_PROC_PKT_SYNC_PARAMS_5_SLOT_0_ADDR A:0x67940814
y.create.l HWIO_IPA_IPA_PROC_PKT_SYNC_PARAMS_5_SLOT_1_ADDR A:0x67940854
y.create.l HWIO_IPA_IPA_PROC_PKT_SYNC_PARAMS_5_SLOT_2_ADDR A:0x67940894
y.create.l HWIO_IPA_IPA_PROC_PKT_SYNC_PARAMS_5_SLOT_3_ADDR A:0x679408d4
y.create.l HWIO_IPA_IPA_PROC_PKT_SYNC_PARAMS_5_SLOT_4_ADDR A:0x67940914
y.create.l HWIO_IPA_IPA_PROC_PKT_SYNC_PARAMS_6_SLOT_0_ADDR A:0x67940818
y.create.l HWIO_IPA_IPA_PROC_PKT_SYNC_PARAMS_6_SLOT_1_ADDR A:0x67940858
y.create.l HWIO_IPA_IPA_PROC_PKT_SYNC_PARAMS_6_SLOT_2_ADDR A:0x67940898
y.create.l HWIO_IPA_IPA_PROC_PKT_SYNC_PARAMS_6_SLOT_3_ADDR A:0x679408d8
y.create.l HWIO_IPA_IPA_PROC_PKT_SYNC_PARAMS_6_SLOT_4_ADDR A:0x67940918
y.create.l HWIO_IPA_IPA_PROC_PKT_SYNC_PARAMS_7_SLOT_0_ADDR A:0x6794081c
y.create.l HWIO_IPA_IPA_PROC_PKT_SYNC_PARAMS_7_SLOT_1_ADDR A:0x6794085c
y.create.l HWIO_IPA_IPA_PROC_PKT_SYNC_PARAMS_7_SLOT_2_ADDR A:0x6794089c
y.create.l HWIO_IPA_IPA_PROC_PKT_SYNC_PARAMS_7_SLOT_3_ADDR A:0x679408dc
y.create.l HWIO_IPA_IPA_PROC_PKT_SYNC_PARAMS_7_SLOT_4_ADDR A:0x6794091c
y.create.l HWIO_IPA_IPA_PROC_PKT_SYNC_PARAMS_8_SLOT_0_ADDR A:0x67940820
y.create.l HWIO_IPA_IPA_PROC_PKT_SYNC_PARAMS_8_SLOT_1_ADDR A:0x67940860
y.create.l HWIO_IPA_IPA_PROC_PKT_SYNC_PARAMS_8_SLOT_2_ADDR A:0x679408a0
y.create.l HWIO_IPA_IPA_PROC_PKT_SYNC_PARAMS_8_SLOT_3_ADDR A:0x679408e0
y.create.l HWIO_IPA_IPA_PROC_PKT_SYNC_PARAMS_8_SLOT_4_ADDR A:0x67940920
y.create.l HWIO_IPA_IPA_PROC_PKT_SYNC_PARAMS_9_SLOT_0_ADDR A:0x67940824
y.create.l HWIO_IPA_IPA_PROC_PKT_SYNC_PARAMS_9_SLOT_1_ADDR A:0x67940864
y.create.l HWIO_IPA_IPA_PROC_PKT_SYNC_PARAMS_9_SLOT_2_ADDR A:0x679408a4
y.create.l HWIO_IPA_IPA_PROC_PKT_SYNC_PARAMS_9_SLOT_3_ADDR A:0x679408e4
y.create.l HWIO_IPA_IPA_PROC_PKT_SYNC_PARAMS_9_SLOT_4_ADDR A:0x67940924
y.create.l HWIO_IPA_IPA_PROC_PKT_SYNC_PARAMS_10_SLOT_0_ADDR A:0x67940828
y.create.l HWIO_IPA_IPA_PROC_PKT_SYNC_PARAMS_10_SLOT_1_ADDR A:0x67940868
y.create.l HWIO_IPA_IPA_PROC_PKT_SYNC_PARAMS_10_SLOT_2_ADDR A:0x679408a8
y.create.l HWIO_IPA_IPA_PROC_PKT_SYNC_PARAMS_10_SLOT_3_ADDR A:0x679408e8
y.create.l HWIO_IPA_IPA_PROC_PKT_SYNC_PARAMS_10_SLOT_4_ADDR A:0x67940928
y.create.l HWIO_IPA_IPA_PROC_PKT_SYNC_PARAMS_11_SLOT_0_ADDR A:0x6794082c
y.create.l HWIO_IPA_IPA_PROC_PKT_SYNC_PARAMS_11_SLOT_1_ADDR A:0x6794086c
y.create.l HWIO_IPA_IPA_PROC_PKT_SYNC_PARAMS_11_SLOT_2_ADDR A:0x679408ac
y.create.l HWIO_IPA_IPA_PROC_PKT_SYNC_PARAMS_11_SLOT_3_ADDR A:0x679408ec
y.create.l HWIO_IPA_IPA_PROC_PKT_SYNC_PARAMS_11_SLOT_4_ADDR A:0x6794092c
y.create.l HWIO_IPA_IPA_PROC_PKT_SYNC_PARAMS_12_SLOT_0_ADDR A:0x67940830
y.create.l HWIO_IPA_IPA_PROC_PKT_SYNC_PARAMS_12_SLOT_1_ADDR A:0x67940870
y.create.l HWIO_IPA_IPA_PROC_PKT_SYNC_PARAMS_12_SLOT_2_ADDR A:0x679408b0
y.create.l HWIO_IPA_IPA_PROC_PKT_SYNC_PARAMS_12_SLOT_3_ADDR A:0x679408f0
y.create.l HWIO_IPA_IPA_PROC_PKT_SYNC_PARAMS_12_SLOT_4_ADDR A:0x67940930
y.create.l HWIO_IPA_IPA_PROC_PKT_SYNC_PARAMS_GLOB_0_ADDR A:0x67943940
y.create.l HWIO_IPA_IPA_PROC_PKT_SYNC_PARAMS_GLOB_1_ADDR A:0x67943944
y.create.l HWIO_IPA_IPA_PROC_PKT_SYNC_PARAMS_GLOB_2_ADDR A:0x67943948
y.create.l HWIO_IPA_IPA_PROC_PKT_SYNC_PARAMS_GLOB_3_ADDR A:0x6794394c
y.create.l HWIO_IPA_IPA_ENDP_INIT_CTRL_0_ADDR A:0x67940070
y.create.l HWIO_IPA_IPA_ENDP_INIT_CTRL_1_ADDR A:0x67940074
y.create.l HWIO_IPA_IPA_ENDP_INIT_CTRL_2_ADDR A:0x67940078
y.create.l HWIO_IPA_IPA_ENDP_INIT_CTRL_3_ADDR A:0x6794007c
y.create.l HWIO_IPA_IPA_ENDP_INIT_CTRL_4_ADDR A:0x67940080
y.create.l HWIO_IPA_IPA_ENDP_INIT_CTRL_5_ADDR A:0x67940084
y.create.l HWIO_IPA_IPA_ENDP_INIT_CTRL_6_ADDR A:0x67940088
y.create.l HWIO_IPA_IPA_ENDP_INIT_CTRL_7_ADDR A:0x6794008c
y.create.l HWIO_IPA_IPA_ENDP_INIT_CTRL_8_ADDR A:0x67940090
y.create.l HWIO_IPA_IPA_ENDP_INIT_CTRL_9_ADDR A:0x67940094
y.create.l HWIO_IPA_IPA_ENDP_INIT_CTRL_SCND_0_ADDR A:0x67940690
y.create.l HWIO_IPA_IPA_ENDP_INIT_CTRL_SCND_1_ADDR A:0x67940694
y.create.l HWIO_IPA_IPA_ENDP_INIT_CTRL_SCND_2_ADDR A:0x67940698
y.create.l HWIO_IPA_IPA_ENDP_INIT_CTRL_SCND_3_ADDR A:0x6794069c
y.create.l HWIO_IPA_IPA_ENDP_INIT_CTRL_SCND_4_ADDR A:0x679406a0
y.create.l HWIO_IPA_IPA_ENDP_INIT_CTRL_SCND_5_ADDR A:0x679406a4
y.create.l HWIO_IPA_IPA_ENDP_INIT_CTRL_SCND_6_ADDR A:0x679406a8
y.create.l HWIO_IPA_IPA_ENDP_INIT_CTRL_SCND_7_ADDR A:0x679406ac
y.create.l HWIO_IPA_IPA_ENDP_INIT_CTRL_SCND_8_ADDR A:0x679406b0
y.create.l HWIO_IPA_IPA_ENDP_INIT_CTRL_SCND_9_ADDR A:0x679406b4
y.create.l HWIO_IPA_IPA_ENDP_INIT_CFG_0_ADDR A:0x679400c0
y.create.l HWIO_IPA_IPA_ENDP_INIT_CFG_1_ADDR A:0x679400c4
y.create.l HWIO_IPA_IPA_ENDP_INIT_CFG_2_ADDR A:0x679400c8
y.create.l HWIO_IPA_IPA_ENDP_INIT_CFG_3_ADDR A:0x679400cc
y.create.l HWIO_IPA_IPA_ENDP_INIT_CFG_4_ADDR A:0x679400d0
y.create.l HWIO_IPA_IPA_ENDP_INIT_CFG_5_ADDR A:0x679400d4
y.create.l HWIO_IPA_IPA_ENDP_INIT_CFG_6_ADDR A:0x679400d8
y.create.l HWIO_IPA_IPA_ENDP_INIT_CFG_7_ADDR A:0x679400dc
y.create.l HWIO_IPA_IPA_ENDP_INIT_CFG_8_ADDR A:0x679400e0
y.create.l HWIO_IPA_IPA_ENDP_INIT_CFG_9_ADDR A:0x679400e4
y.create.l HWIO_IPA_IPA_ENDP_INIT_NAT_0_ADDR A:0x67940120
y.create.l HWIO_IPA_IPA_ENDP_INIT_NAT_1_ADDR A:0x67940124
y.create.l HWIO_IPA_IPA_ENDP_INIT_NAT_2_ADDR A:0x67940128
y.create.l HWIO_IPA_IPA_ENDP_INIT_NAT_3_ADDR A:0x6794012c
y.create.l HWIO_IPA_IPA_ENDP_INIT_NAT_4_ADDR A:0x67940130
y.create.l HWIO_IPA_IPA_ENDP_INIT_NAT_5_ADDR A:0x67940134
y.create.l HWIO_IPA_IPA_ENDP_INIT_NAT_6_ADDR A:0x67940138
y.create.l HWIO_IPA_IPA_ENDP_INIT_NAT_7_ADDR A:0x6794013c
y.create.l HWIO_IPA_IPA_ENDP_INIT_NAT_8_ADDR A:0x67940140
y.create.l HWIO_IPA_IPA_ENDP_INIT_NAT_9_ADDR A:0x67940144
y.create.l HWIO_IPA_IPA_ENDP_INIT_HDR_0_ADDR A:0x67940170
y.create.l HWIO_IPA_IPA_ENDP_INIT_HDR_1_ADDR A:0x67940174
y.create.l HWIO_IPA_IPA_ENDP_INIT_HDR_2_ADDR A:0x67940178
y.create.l HWIO_IPA_IPA_ENDP_INIT_HDR_3_ADDR A:0x6794017c
y.create.l HWIO_IPA_IPA_ENDP_INIT_HDR_4_ADDR A:0x67940180
y.create.l HWIO_IPA_IPA_ENDP_INIT_HDR_5_ADDR A:0x67940184
y.create.l HWIO_IPA_IPA_ENDP_INIT_HDR_6_ADDR A:0x67940188
y.create.l HWIO_IPA_IPA_ENDP_INIT_HDR_7_ADDR A:0x6794018c
y.create.l HWIO_IPA_IPA_ENDP_INIT_HDR_8_ADDR A:0x67940190
y.create.l HWIO_IPA_IPA_ENDP_INIT_HDR_9_ADDR A:0x67940194
y.create.l HWIO_IPA_IPA_ENDP_INIT_HDR_EXT_0_ADDR A:0x679401c0
y.create.l HWIO_IPA_IPA_ENDP_INIT_HDR_EXT_1_ADDR A:0x679401c4
y.create.l HWIO_IPA_IPA_ENDP_INIT_HDR_EXT_2_ADDR A:0x679401c8
y.create.l HWIO_IPA_IPA_ENDP_INIT_HDR_EXT_3_ADDR A:0x679401cc
y.create.l HWIO_IPA_IPA_ENDP_INIT_HDR_EXT_4_ADDR A:0x679401d0
y.create.l HWIO_IPA_IPA_ENDP_INIT_HDR_EXT_5_ADDR A:0x679401d4
y.create.l HWIO_IPA_IPA_ENDP_INIT_HDR_EXT_6_ADDR A:0x679401d8
y.create.l HWIO_IPA_IPA_ENDP_INIT_HDR_EXT_7_ADDR A:0x679401dc
y.create.l HWIO_IPA_IPA_ENDP_INIT_HDR_EXT_8_ADDR A:0x679401e0
y.create.l HWIO_IPA_IPA_ENDP_INIT_HDR_EXT_9_ADDR A:0x679401e4
y.create.l HWIO_IPA_IPA_ENDP_INIT_HDR_METADATA_MASK_0_ADDR A:0x67940220
y.create.l HWIO_IPA_IPA_ENDP_INIT_HDR_METADATA_MASK_1_ADDR A:0x67940224
y.create.l HWIO_IPA_IPA_ENDP_INIT_HDR_METADATA_MASK_2_ADDR A:0x67940228
y.create.l HWIO_IPA_IPA_ENDP_INIT_HDR_METADATA_MASK_3_ADDR A:0x6794022c
y.create.l HWIO_IPA_IPA_ENDP_INIT_HDR_METADATA_MASK_4_ADDR A:0x67940230
y.create.l HWIO_IPA_IPA_ENDP_INIT_HDR_METADATA_MASK_5_ADDR A:0x67940234
y.create.l HWIO_IPA_IPA_ENDP_INIT_HDR_METADATA_MASK_6_ADDR A:0x67940238
y.create.l HWIO_IPA_IPA_ENDP_INIT_HDR_METADATA_MASK_7_ADDR A:0x6794023c
y.create.l HWIO_IPA_IPA_ENDP_INIT_HDR_METADATA_MASK_8_ADDR A:0x67940240
y.create.l HWIO_IPA_IPA_ENDP_INIT_HDR_METADATA_MASK_9_ADDR A:0x67940244
y.create.l HWIO_IPA_IPA_ENDP_INIT_HDR_METADATA_0_ADDR A:0x67940270
y.create.l HWIO_IPA_IPA_ENDP_INIT_HDR_METADATA_1_ADDR A:0x67940274
y.create.l HWIO_IPA_IPA_ENDP_INIT_HDR_METADATA_2_ADDR A:0x67940278
y.create.l HWIO_IPA_IPA_ENDP_INIT_HDR_METADATA_3_ADDR A:0x6794027c
y.create.l HWIO_IPA_IPA_ENDP_INIT_HDR_METADATA_4_ADDR A:0x67940280
y.create.l HWIO_IPA_IPA_ENDP_INIT_HDR_METADATA_5_ADDR A:0x67940284
y.create.l HWIO_IPA_IPA_ENDP_INIT_HDR_METADATA_6_ADDR A:0x67940288
y.create.l HWIO_IPA_IPA_ENDP_INIT_HDR_METADATA_7_ADDR A:0x6794028c
y.create.l HWIO_IPA_IPA_ENDP_INIT_HDR_METADATA_8_ADDR A:0x67940290
y.create.l HWIO_IPA_IPA_ENDP_INIT_HDR_METADATA_9_ADDR A:0x67940294
y.create.l HWIO_IPA_IPA_ENDP_INIT_MODE_0_ADDR A:0x679402c0
y.create.l HWIO_IPA_IPA_ENDP_INIT_MODE_1_ADDR A:0x679402c4
y.create.l HWIO_IPA_IPA_ENDP_INIT_MODE_2_ADDR A:0x679402c8
y.create.l HWIO_IPA_IPA_ENDP_INIT_MODE_3_ADDR A:0x679402cc
y.create.l HWIO_IPA_IPA_ENDP_INIT_MODE_4_ADDR A:0x679402d0
y.create.l HWIO_IPA_IPA_ENDP_INIT_MODE_5_ADDR A:0x679402d4
y.create.l HWIO_IPA_IPA_ENDP_INIT_MODE_6_ADDR A:0x679402d8
y.create.l HWIO_IPA_IPA_ENDP_INIT_MODE_7_ADDR A:0x679402dc
y.create.l HWIO_IPA_IPA_ENDP_INIT_MODE_8_ADDR A:0x679402e0
y.create.l HWIO_IPA_IPA_ENDP_INIT_MODE_9_ADDR A:0x679402e4
y.create.l HWIO_IPA_IPA_ENDP_INIT_AGGR_0_ADDR A:0x67940320
y.create.l HWIO_IPA_IPA_ENDP_INIT_AGGR_1_ADDR A:0x67940324
y.create.l HWIO_IPA_IPA_ENDP_INIT_AGGR_2_ADDR A:0x67940328
y.create.l HWIO_IPA_IPA_ENDP_INIT_AGGR_3_ADDR A:0x6794032c
y.create.l HWIO_IPA_IPA_ENDP_INIT_AGGR_4_ADDR A:0x67940330
y.create.l HWIO_IPA_IPA_ENDP_INIT_AGGR_5_ADDR A:0x67940334
y.create.l HWIO_IPA_IPA_ENDP_INIT_AGGR_6_ADDR A:0x67940338
y.create.l HWIO_IPA_IPA_ENDP_INIT_AGGR_7_ADDR A:0x6794033c
y.create.l HWIO_IPA_IPA_ENDP_INIT_AGGR_8_ADDR A:0x67940340
y.create.l HWIO_IPA_IPA_ENDP_INIT_AGGR_9_ADDR A:0x67940344
y.create.l HWIO_IPA_IPA_ENDP_INIT_ROUTE_0_ADDR A:0x67940370
y.create.l HWIO_IPA_IPA_ENDP_INIT_ROUTE_1_ADDR A:0x67940374
y.create.l HWIO_IPA_IPA_ENDP_INIT_ROUTE_2_ADDR A:0x67940378
y.create.l HWIO_IPA_IPA_ENDP_INIT_ROUTE_3_ADDR A:0x6794037c
y.create.l HWIO_IPA_IPA_ENDP_INIT_ROUTE_4_ADDR A:0x67940380
y.create.l HWIO_IPA_IPA_ENDP_INIT_ROUTE_5_ADDR A:0x67940384
y.create.l HWIO_IPA_IPA_ENDP_INIT_ROUTE_6_ADDR A:0x67940388
y.create.l HWIO_IPA_IPA_ENDP_INIT_ROUTE_7_ADDR A:0x6794038c
y.create.l HWIO_IPA_IPA_ENDP_INIT_ROUTE_8_ADDR A:0x67940390
y.create.l HWIO_IPA_IPA_ENDP_INIT_ROUTE_9_ADDR A:0x67940394
y.create.l HWIO_IPA_IPA_ENDP_INIT_HOL_BLOCK_EN_0_ADDR A:0x679403c0
y.create.l HWIO_IPA_IPA_ENDP_INIT_HOL_BLOCK_EN_1_ADDR A:0x679403c4
y.create.l HWIO_IPA_IPA_ENDP_INIT_HOL_BLOCK_EN_2_ADDR A:0x679403c8
y.create.l HWIO_IPA_IPA_ENDP_INIT_HOL_BLOCK_EN_3_ADDR A:0x679403cc
y.create.l HWIO_IPA_IPA_ENDP_INIT_HOL_BLOCK_EN_4_ADDR A:0x679403d0
y.create.l HWIO_IPA_IPA_ENDP_INIT_HOL_BLOCK_EN_5_ADDR A:0x679403d4
y.create.l HWIO_IPA_IPA_ENDP_INIT_HOL_BLOCK_EN_6_ADDR A:0x679403d8
y.create.l HWIO_IPA_IPA_ENDP_INIT_HOL_BLOCK_EN_7_ADDR A:0x679403dc
y.create.l HWIO_IPA_IPA_ENDP_INIT_HOL_BLOCK_EN_8_ADDR A:0x679403e0
y.create.l HWIO_IPA_IPA_ENDP_INIT_HOL_BLOCK_EN_9_ADDR A:0x679403e4
y.create.l HWIO_IPA_IPA_ENDP_INIT_HOL_BLOCK_TIMER_0_ADDR A:0x67940420
y.create.l HWIO_IPA_IPA_ENDP_INIT_HOL_BLOCK_TIMER_1_ADDR A:0x67940424
y.create.l HWIO_IPA_IPA_ENDP_INIT_HOL_BLOCK_TIMER_2_ADDR A:0x67940428
y.create.l HWIO_IPA_IPA_ENDP_INIT_HOL_BLOCK_TIMER_3_ADDR A:0x6794042c
y.create.l HWIO_IPA_IPA_ENDP_INIT_HOL_BLOCK_TIMER_4_ADDR A:0x67940430
y.create.l HWIO_IPA_IPA_ENDP_INIT_HOL_BLOCK_TIMER_5_ADDR A:0x67940434
y.create.l HWIO_IPA_IPA_ENDP_INIT_HOL_BLOCK_TIMER_6_ADDR A:0x67940438
y.create.l HWIO_IPA_IPA_ENDP_INIT_HOL_BLOCK_TIMER_7_ADDR A:0x6794043c
y.create.l HWIO_IPA_IPA_ENDP_INIT_HOL_BLOCK_TIMER_8_ADDR A:0x67940440
y.create.l HWIO_IPA_IPA_ENDP_INIT_HOL_BLOCK_TIMER_9_ADDR A:0x67940444
y.create.l HWIO_IPA_IPA_ENDP_INIT_DEAGGR_0_ADDR A:0x67940470
y.create.l HWIO_IPA_IPA_ENDP_INIT_DEAGGR_1_ADDR A:0x67940474
y.create.l HWIO_IPA_IPA_ENDP_INIT_DEAGGR_2_ADDR A:0x67940478
y.create.l HWIO_IPA_IPA_ENDP_INIT_DEAGGR_3_ADDR A:0x6794047c
y.create.l HWIO_IPA_IPA_ENDP_INIT_DEAGGR_4_ADDR A:0x67940480
y.create.l HWIO_IPA_IPA_ENDP_INIT_DEAGGR_5_ADDR A:0x67940484
y.create.l HWIO_IPA_IPA_ENDP_INIT_DEAGGR_6_ADDR A:0x67940488
y.create.l HWIO_IPA_IPA_ENDP_INIT_DEAGGR_7_ADDR A:0x6794048c
y.create.l HWIO_IPA_IPA_ENDP_INIT_DEAGGR_8_ADDR A:0x67940490
y.create.l HWIO_IPA_IPA_ENDP_INIT_DEAGGR_9_ADDR A:0x67940494
y.create.l HWIO_IPA_IPA_ENDP_STATUS_0_ADDR A:0x679404c0
y.create.l HWIO_IPA_IPA_ENDP_STATUS_1_ADDR A:0x679404c4
y.create.l HWIO_IPA_IPA_ENDP_STATUS_2_ADDR A:0x679404c8
y.create.l HWIO_IPA_IPA_ENDP_STATUS_3_ADDR A:0x679404cc
y.create.l HWIO_IPA_IPA_ENDP_STATUS_4_ADDR A:0x679404d0
y.create.l HWIO_IPA_IPA_ENDP_STATUS_5_ADDR A:0x679404d4
y.create.l HWIO_IPA_IPA_ENDP_STATUS_6_ADDR A:0x679404d8
y.create.l HWIO_IPA_IPA_ENDP_STATUS_7_ADDR A:0x679404dc
y.create.l HWIO_IPA_IPA_ENDP_STATUS_8_ADDR A:0x679404e0
y.create.l HWIO_IPA_IPA_ENDP_STATUS_9_ADDR A:0x679404e4
y.create.l HWIO_IPA_IPA_AGGR_FORCE_CLOSE_ADDR A:0x679405a0
y.create.l HWIO_IPA_IPA_DEBUG_CNT_REG_0_ADDR A:0x67940600
y.create.l HWIO_IPA_IPA_DEBUG_CNT_REG_1_ADDR A:0x67940604
y.create.l HWIO_IPA_IPA_DEBUG_CNT_REG_2_ADDR A:0x67940608
y.create.l HWIO_IPA_IPA_DEBUG_CNT_REG_3_ADDR A:0x6794060c
y.create.l HWIO_IPA_IPA_DEBUG_CNT_REG_4_ADDR A:0x67940610
y.create.l HWIO_IPA_IPA_DEBUG_CNT_REG_5_ADDR A:0x67940614
y.create.l HWIO_IPA_IPA_DEBUG_CNT_REG_6_ADDR A:0x67940618
y.create.l HWIO_IPA_IPA_DEBUG_CNT_REG_7_ADDR A:0x6794061c
y.create.l HWIO_IPA_IPA_DEBUG_CNT_REG_8_ADDR A:0x67940620
y.create.l HWIO_IPA_IPA_DEBUG_CNT_REG_9_ADDR A:0x67940624
y.create.l HWIO_IPA_IPA_DEBUG_CNT_CTRL_0_ADDR A:0x67940640
y.create.l HWIO_IPA_IPA_DEBUG_CNT_CTRL_1_ADDR A:0x67940644
y.create.l HWIO_IPA_IPA_DEBUG_CNT_CTRL_2_ADDR A:0x67940648
y.create.l HWIO_IPA_IPA_DEBUG_CNT_CTRL_3_ADDR A:0x6794064c
y.create.l HWIO_IPA_IPA_DEBUG_CNT_CTRL_4_ADDR A:0x67940650
y.create.l HWIO_IPA_IPA_DEBUG_CNT_CTRL_5_ADDR A:0x67940654
y.create.l HWIO_IPA_IPA_DEBUG_CNT_CTRL_6_ADDR A:0x67940658
y.create.l HWIO_IPA_IPA_DEBUG_CNT_CTRL_7_ADDR A:0x6794065c
y.create.l HWIO_IPA_IPA_DEBUG_CNT_CTRL_8_ADDR A:0x67940660
y.create.l HWIO_IPA_IPA_DEBUG_CNT_CTRL_9_ADDR A:0x67940664
y.create.l HWIO_IPA_IPA_DEBUG_DATA_SEL_ADDR A:0x67943028
y.create.l HWIO_IPA_IPA_DEBUG_DATA_ADDR A:0x6794302c
y.create.l HWIO_IPA_IPA_TESTBUS_SEL_ADDR A:0x67943030
y.create.l HWIO_IPA_IPA_RX_PROC_CMDQ_CMD_ADDR A:0x67943034
y.create.l HWIO_IPA_IPA_RX_PROC_CMDQ_CFG_ADDR A:0x67943038
y.create.l HWIO_IPA_IPA_RX_PROC_CMDQ_DATA_WR_0_ADDR A:0x6794303c
y.create.l HWIO_IPA_IPA_RX_PROC_CMDQ_DATA_WR_1_ADDR A:0x67943040
y.create.l HWIO_IPA_IPA_RX_PROC_CMDQ_DATA_WR_2_ADDR A:0x67943044
y.create.l HWIO_IPA_IPA_RX_PROC_CMDQ_DATA_RD_0_ADDR A:0x67943048
y.create.l HWIO_IPA_IPA_RX_PROC_CMDQ_DATA_RD_1_ADDR A:0x6794304c
y.create.l HWIO_IPA_IPA_RX_PROC_CMDQ_DATA_RD_2_ADDR A:0x67943050
y.create.l HWIO_IPA_IPA_RX_PROC_CMDQ_STATUS_ADDR A:0x67943054
y.create.l HWIO_IPA_IPA_PROC_TX_CMDQ_CMD_ADDR A:0x67943058
y.create.l HWIO_IPA_IPA_PROC_TX_CMDQ_CFG_ADDR A:0x6794305c
y.create.l HWIO_IPA_IPA_PROC_TX_CMDQ_DATA_WR_0_ADDR A:0x67943060
y.create.l HWIO_IPA_IPA_PROC_TX_CMDQ_DATA_WR_1_ADDR A:0x67943064
y.create.l HWIO_IPA_IPA_PROC_TX_CMDQ_DATA_RD_0_ADDR A:0x67943068
y.create.l HWIO_IPA_IPA_PROC_TX_CMDQ_DATA_RD_1_ADDR A:0x6794306c
y.create.l HWIO_IPA_IPA_PROC_TX_CMDQ_STATUS_ADDR A:0x67943070
y.create.l HWIO_IPA_IPA_PROC_RX_ACKQ_CMD_ADDR A:0x67943100
y.create.l HWIO_IPA_IPA_PROC_RX_ACKQ_CFG_ADDR A:0x67943104
y.create.l HWIO_IPA_IPA_PROC_RX_ACKQ_DATA_WR_0_ADDR A:0x67943108
y.create.l HWIO_IPA_IPA_PROC_RX_ACKQ_DATA_RD_0_ADDR A:0x6794310c
y.create.l HWIO_IPA_IPA_PROC_RX_ACKQ_STATUS_ADDR A:0x67943110
y.create.l HWIO_IPA_IPA_TX_PROC_ACKQ_CMD_ADDR A:0x67943114
y.create.l HWIO_IPA_IPA_TX_PROC_ACKQ_CFG_ADDR A:0x67943118
y.create.l HWIO_IPA_IPA_TX_PROC_ACKQ_DATA_WR_0_ADDR A:0x6794311c
y.create.l HWIO_IPA_IPA_TX_PROC_ACKQ_DATA_RD_0_ADDR A:0x67943120
y.create.l HWIO_IPA_IPA_TX_PROC_ACKQ_STATUS_ADDR A:0x67943124
y.create.l HWIO_IPA_IPA_UC_PROC_RX_CMDQ_CMD_ADDR A:0x67943128
y.create.l HWIO_IPA_IPA_UC_PROC_RX_CMDQ_CFG_ADDR A:0x6794312c
y.create.l HWIO_IPA_IPA_UC_PROC_RX_CMDQ_DATA_WR_0_ADDR A:0x67943130
y.create.l HWIO_IPA_IPA_UC_PROC_RX_CMDQ_DATA_WR_1_ADDR A:0x67943134
y.create.l HWIO_IPA_IPA_UC_PROC_RX_CMDQ_DATA_WR_2_ADDR A:0x67943138
y.create.l HWIO_IPA_IPA_UC_PROC_RX_CMDQ_DATA_RD_0_ADDR A:0x6794313c
y.create.l HWIO_IPA_IPA_UC_PROC_RX_CMDQ_DATA_RD_1_ADDR A:0x67943140
y.create.l HWIO_IPA_IPA_UC_PROC_RX_CMDQ_DATA_RD_2_ADDR A:0x67943144
y.create.l HWIO_IPA_IPA_UC_PROC_RX_CMDQ_STATUS_ADDR A:0x67943148
y.create.l HWIO_IPA_IPA_UC_PROC_TX_CMDQ_CMD_ADDR A:0x6794314c
y.create.l HWIO_IPA_IPA_UC_PROC_TX_CMDQ_CFG_ADDR A:0x67943150
y.create.l HWIO_IPA_IPA_UC_PROC_TX_CMDQ_DATA_WR_0_ADDR A:0x67943154
y.create.l HWIO_IPA_IPA_UC_PROC_TX_CMDQ_DATA_WR_1_ADDR A:0x67943158
y.create.l HWIO_IPA_IPA_UC_PROC_TX_CMDQ_DATA_RD_0_ADDR A:0x6794315c
y.create.l HWIO_IPA_IPA_UC_PROC_TX_CMDQ_DATA_RD_1_ADDR A:0x67943160
y.create.l HWIO_IPA_IPA_UC_PROC_TX_CMDQ_STATUS_ADDR A:0x67943164
y.create.l HWIO_IPA_IPA_PROC_UC_CMDQ_CMD_ADDR A:0x67943168
y.create.l HWIO_IPA_IPA_PROC_UC_CMDQ_CFG_ADDR A:0x6794316c
y.create.l HWIO_IPA_IPA_PROC_UC_CMDQ_DATA_WR_0_ADDR A:0x67943170
y.create.l HWIO_IPA_IPA_PROC_UC_CMDQ_DATA_WR_1_ADDR A:0x67943174
y.create.l HWIO_IPA_IPA_PROC_UC_CMDQ_DATA_RD_0_ADDR A:0x67943178
y.create.l HWIO_IPA_IPA_PROC_UC_CMDQ_DATA_RD_1_ADDR A:0x6794317c
y.create.l HWIO_IPA_IPA_PROC_UC_CMDQ_STATUS_ADDR A:0x67943180
y.create.l HWIO_IPA_IPA_UC_PROC_ACKQ_CMD_ADDR A:0x67943184
y.create.l HWIO_IPA_IPA_UC_PROC_ACKQ_CFG_ADDR A:0x67943188
y.create.l HWIO_IPA_IPA_UC_PROC_ACKQ_DATA_WR_0_ADDR A:0x6794318c
y.create.l HWIO_IPA_IPA_UC_PROC_ACKQ_DATA_RD_0_ADDR A:0x67943190
y.create.l HWIO_IPA_IPA_UC_PROC_ACKQ_STATUS_ADDR A:0x67943194
y.create.l HWIO_IPA_IPA_PROC_UC_ACKQ_CMD_ADDR A:0x67943198
y.create.l HWIO_IPA_IPA_PROC_UC_ACKQ_CFG_ADDR A:0x6794319c
y.create.l HWIO_IPA_IPA_PROC_UC_ACKQ_DATA_WR_0_ADDR A:0x679431a0
y.create.l HWIO_IPA_IPA_PROC_UC_ACKQ_DATA_RD_0_ADDR A:0x679431a4
y.create.l HWIO_IPA_IPA_PROC_UC_ACKQ_STATUS_ADDR A:0x679431a8
y.create.l HWIO_IPA_IPA_STEP_MODE_BREAKPOINTS_ADDR A:0x67943074
y.create.l HWIO_IPA_IPA_STEP_MODE_STATUS_ADDR A:0x67943078
y.create.l HWIO_IPA_IPA_STEP_MODE_GO_ADDR A:0x6794307c
y.create.l HWIO_IPA_IPA_HW_EVENTS_CFG_ADDR A:0x67943084
y.create.l HWIO_IPA_IPA_REPLICATE_ADDR A:0x67943088
y.create.l HWIO_IPA_IPA_LOG_BUF_STATUS_ADDR_ADDR A:0x679420a0
y.create.l HWIO_IPA_IPA_LOG_BUF_STATUS_WRITE_PTR_ADDR A:0x679420a4
y.create.l HWIO_IPA_IPA_LOG_BUF_STATUS_CFG_ADDR A:0x679420a8
y.create.l HWIO_IPA_IPA_LOG_BUF_STATUS_RAM_PTR_ADDR A:0x679420ac
y.create.l HWIO_IPA_IPA_LOG_BUF_HW_CMD_ADDR_ADDR A:0x679430ac
y.create.l HWIO_IPA_IPA_LOG_BUF_HW_CMD_WRITE_PTR_ADDR A:0x679430b0
y.create.l HWIO_IPA_IPA_LOG_BUF_HW_CMD_CFG_ADDR A:0x679430b4
y.create.l HWIO_IPA_IPA_LOG_BUF_HW_CMD_RAM_PTR_ADDR A:0x679430b8
y.create.l HWIO_IPA_IPA_LTE_DECIPH_INIT_VALUES_0_ADDR A:0x679420c0
y.create.l HWIO_IPA_IPA_LTE_DECIPH_INIT_VALUES_1_ADDR A:0x679420c4
y.create.l HWIO_IPA_IPA_SPARE_REG_1_ADDR A:0x67943090
y.create.l HWIO_IPA_IPA_SPARE_REG_2_ADDR A:0x67943094
y.create.l HWIO_IPA_IPA_SRAM_DIRECT_ACCESS_0_ADDR A:0x67945000
y.create.l HWIO_IPA_IPA_SRAM_DIRECT_ACCESS_1_ADDR A:0x67945004
y.create.l HWIO_IPA_IPA_SRAM_DIRECT_ACCESS_2_ADDR A:0x67945008
y.create.l HWIO_IPA_IPA_SRAM_DIRECT_ACCESS_3_ADDR A:0x6794500c
y.create.l HWIO_IPA_IPA_SRAM_DIRECT_ACCESS_4_ADDR A:0x67945010
y.create.l HWIO_IPA_IPA_SRAM_DIRECT_ACCESS_5_ADDR A:0x67945014
y.create.l HWIO_IPA_IPA_SRAM_DIRECT_ACCESS_6_ADDR A:0x67945018
y.create.l HWIO_IPA_IPA_SRAM_DIRECT_ACCESS_7_ADDR A:0x6794501c
y.create.l HWIO_IPA_IPA_SRAM_DIRECT_ACCESS_8_ADDR A:0x67945020
y.create.l HWIO_IPA_IPA_SRAM_DIRECT_ACCESS_9_ADDR A:0x67945024
y.create.l HWIO_IPA_IPA_UC_IRAM_START_ADDR A:0x67950000
y.create.l HWIO_IPA_IPA_UC_DRAM_START_ADDR A:0x67954000
y.create.l HWIO_IPA_IPA_UC_STATUS_ADDR A:0x67960000
y.create.l HWIO_IPA_IPA_UC_CONTROL_ADDR A:0x67960004
y.create.l HWIO_IPA_IPA_UC_BASE_ADDR_ADDR A:0x67960008
y.create.l HWIO_IPA_IPA_UC_SYS_BUS_ATTRIB_ADDR A:0x6796000c
y.create.l HWIO_IPA_IPA_UC_QMB_SYS_ADDR_ADDR A:0x67960100
y.create.l HWIO_IPA_IPA_UC_QMB_LOCAL_ADDR_ADDR A:0x67960104
y.create.l HWIO_IPA_IPA_UC_QMB_LENGTH_ADDR A:0x67960108
y.create.l HWIO_IPA_IPA_UC_QMB_TRIGGER_ADDR A:0x6796010c
y.create.l HWIO_IPA_IPA_UC_QMB_PENDING_TID_ADDR A:0x67960110
y.create.l HWIO_IPA_IPA_UC_QMB_COMPLETED_RD_FIFO_ADDR A:0x67960114
y.create.l HWIO_IPA_IPA_UC_QMB_COMPLETED_RD_FIFO_PEEK_ADDR A:0x67960118
y.create.l HWIO_IPA_IPA_UC_QMB_COMPLETED_WR_FIFO_ADDR A:0x6796011c
y.create.l HWIO_IPA_IPA_UC_QMB_COMPLETED_WR_FIFO_PEEK_ADDR A:0x67960120
y.create.l HWIO_IPA_IPA_UC_QMB_MISC_ADDR A:0x67960124
y.create.l HWIO_IPA_IPA_UC_QMB_STATUS_ADDR A:0x67960128
y.create.l HWIO_IPA_IPA_UC_QMB_BUS_ATTRIB_ADDR A:0x6796012c
y.create.l HWIO_IPA_IPA_UC_MBOX_INT_STTS_0_ADDR A:0x67960200
y.create.l HWIO_IPA_IPA_UC_MBOX_INT_STTS_1_ADDR A:0x67960210
y.create.l HWIO_IPA_IPA_UC_MBOX_INT_STTS_2_ADDR A:0x67960220
y.create.l HWIO_IPA_IPA_UC_MBOX_INT_STTS_3_ADDR A:0x67960230
y.create.l HWIO_IPA_IPA_UC_MBOX_INT_STTS_4_ADDR A:0x67960240
y.create.l HWIO_IPA_IPA_UC_MBOX_INT_STTS_5_ADDR A:0x67960250
y.create.l HWIO_IPA_IPA_UC_MBOX_INT_STTS_6_ADDR A:0x67960260
y.create.l HWIO_IPA_IPA_UC_MBOX_INT_STTS_7_ADDR A:0x67960270
y.create.l HWIO_IPA_IPA_UC_MBOX_INT_EN_0_ADDR A:0x67960204
y.create.l HWIO_IPA_IPA_UC_MBOX_INT_EN_1_ADDR A:0x67960214
y.create.l HWIO_IPA_IPA_UC_MBOX_INT_EN_2_ADDR A:0x67960224
y.create.l HWIO_IPA_IPA_UC_MBOX_INT_EN_3_ADDR A:0x67960234
y.create.l HWIO_IPA_IPA_UC_MBOX_INT_EN_4_ADDR A:0x67960244
y.create.l HWIO_IPA_IPA_UC_MBOX_INT_EN_5_ADDR A:0x67960254
y.create.l HWIO_IPA_IPA_UC_MBOX_INT_EN_6_ADDR A:0x67960264
y.create.l HWIO_IPA_IPA_UC_MBOX_INT_EN_7_ADDR A:0x67960274
y.create.l HWIO_IPA_IPA_UC_MBOX_INT_CLR_0_ADDR A:0x67960208
y.create.l HWIO_IPA_IPA_UC_MBOX_INT_CLR_1_ADDR A:0x67960218
y.create.l HWIO_IPA_IPA_UC_MBOX_INT_CLR_2_ADDR A:0x67960228
y.create.l HWIO_IPA_IPA_UC_MBOX_INT_CLR_3_ADDR A:0x67960238
y.create.l HWIO_IPA_IPA_UC_MBOX_INT_CLR_4_ADDR A:0x67960248
y.create.l HWIO_IPA_IPA_UC_MBOX_INT_CLR_5_ADDR A:0x67960258
y.create.l HWIO_IPA_IPA_UC_MBOX_INT_CLR_6_ADDR A:0x67960268
y.create.l HWIO_IPA_IPA_UC_MBOX_INT_CLR_7_ADDR A:0x67960278
y.create.l HWIO_IPA_IPA_UC_IPA_INT_STTS_0_ADDR A:0x67960300
y.create.l HWIO_IPA_IPA_UC_IPA_INT_STTS_1_ADDR A:0x67960310
y.create.l HWIO_IPA_IPA_UC_IPA_INT_STTS_2_ADDR A:0x67960320
y.create.l HWIO_IPA_IPA_UC_IPA_INT_STTS_3_ADDR A:0x67960330
y.create.l HWIO_IPA_IPA_UC_IPA_INT_EN_0_ADDR A:0x67960304
y.create.l HWIO_IPA_IPA_UC_IPA_INT_EN_1_ADDR A:0x67960314
y.create.l HWIO_IPA_IPA_UC_IPA_INT_EN_2_ADDR A:0x67960324
y.create.l HWIO_IPA_IPA_UC_IPA_INT_EN_3_ADDR A:0x67960334
y.create.l HWIO_IPA_IPA_UC_IPA_INT_CLR_0_ADDR A:0x67960308
y.create.l HWIO_IPA_IPA_UC_IPA_INT_CLR_1_ADDR A:0x67960318
y.create.l HWIO_IPA_IPA_UC_IPA_INT_CLR_2_ADDR A:0x67960328
y.create.l HWIO_IPA_IPA_UC_IPA_INT_CLR_3_ADDR A:0x67960338
y.create.l HWIO_IPA_IPA_UC_HWEV_INT_STTS_ADDR A:0x67960400
y.create.l HWIO_IPA_IPA_UC_HWEV_INT_EN_ADDR A:0x67960404
y.create.l HWIO_IPA_IPA_UC_HWEV_INT_CLR_ADDR A:0x67960408
y.create.l HWIO_IPA_IPA_UC_SWEV_INT_STTS_ADDR A:0x67960410
y.create.l HWIO_IPA_IPA_UC_SWEV_INT_EN_ADDR A:0x67960414
y.create.l HWIO_IPA_IPA_UC_SWEV_INT_CLR_ADDR A:0x67960418
y.create.l HWIO_IPA_IPA_UC_TIMER_CTRL_0_ADDR A:0x67960500
y.create.l HWIO_IPA_IPA_UC_TIMER_CTRL_1_ADDR A:0x67960510
y.create.l HWIO_IPA_IPA_UC_TIMER_CTRL_2_ADDR A:0x67960520
y.create.l HWIO_IPA_IPA_UC_TIMER_CTRL_3_ADDR A:0x67960530
y.create.l HWIO_IPA_IPA_UC_TIMER_CTRL_R_0_ADDR A:0x67960504
y.create.l HWIO_IPA_IPA_UC_TIMER_CTRL_R_1_ADDR A:0x67960514
y.create.l HWIO_IPA_IPA_UC_TIMER_CTRL_R_2_ADDR A:0x67960524
y.create.l HWIO_IPA_IPA_UC_TIMER_CTRL_R_3_ADDR A:0x67960534
y.create.l HWIO_IPA_IPA_UC_TIMER_STATUS_0_ADDR A:0x67960508
y.create.l HWIO_IPA_IPA_UC_TIMER_STATUS_1_ADDR A:0x67960518
y.create.l HWIO_IPA_IPA_UC_TIMER_STATUS_2_ADDR A:0x67960528
y.create.l HWIO_IPA_IPA_UC_TIMER_STATUS_3_ADDR A:0x67960538
y.create.l HWIO_IPA_IPA_UC_EVENTS_ADDR A:0x67960600
y.create.l HWIO_IPA_IPA_UC_SPARE_ADDR A:0x67961ffc
y.create.l HWIO_IPA_IPA_UC_MAILBOX_0_0_ADDR A:0x67962000
y.create.l HWIO_IPA_IPA_UC_MAILBOX_0_1_ADDR A:0x67962004
y.create.l HWIO_IPA_IPA_UC_MAILBOX_0_2_ADDR A:0x67962008
y.create.l HWIO_IPA_IPA_UC_MAILBOX_0_3_ADDR A:0x6796200c
y.create.l HWIO_IPA_IPA_UC_MAILBOX_1_0_ADDR A:0x67962080
y.create.l HWIO_IPA_IPA_UC_MAILBOX_1_1_ADDR A:0x67962084
y.create.l HWIO_IPA_IPA_UC_MAILBOX_1_2_ADDR A:0x67962088
y.create.l HWIO_IPA_IPA_UC_MAILBOX_1_3_ADDR A:0x6796208c
y.create.l HWIO_IPA_IPA_UC_MAILBOX_2_0_ADDR A:0x67962100
y.create.l HWIO_IPA_IPA_UC_MAILBOX_2_1_ADDR A:0x67962104
y.create.l HWIO_IPA_IPA_UC_MAILBOX_2_2_ADDR A:0x67962108
y.create.l HWIO_IPA_IPA_UC_MAILBOX_2_3_ADDR A:0x6796210c
y.create.l HWIO_IPA_IPA_UC_MAILBOX_3_0_ADDR A:0x67962180
y.create.l HWIO_IPA_IPA_UC_MAILBOX_3_1_ADDR A:0x67962184
y.create.l HWIO_IPA_IPA_UC_MAILBOX_3_2_ADDR A:0x67962188
y.create.l HWIO_IPA_IPA_UC_MAILBOX_3_3_ADDR A:0x6796218c
y.create.l HWIO_MSS_RELAY_MSG_BUFFER_00_ADDR A:0x64180000
y.create.l HWIO_MSS_RELAY_MSG_BUFFER_01_ADDR A:0x64180004
y.create.l HWIO_MSS_RELAY_MSG_BUFFER_02_ADDR A:0x64180008
y.create.l HWIO_MSS_RELAY_MSG_BUFFER_03_ADDR A:0x6418000c
y.create.l HWIO_MSS_RELAY_MSG_BUFFER_04_ADDR A:0x64180010
y.create.l HWIO_MSS_RELAY_MSG_BUFFER_05_ADDR A:0x64180014
y.create.l HWIO_MSS_RELAY_MSG_BUFFER_06_ADDR A:0x64180018
y.create.l HWIO_MSS_RELAY_MSG_BUFFER_07_ADDR A:0x6418001c
y.create.l HWIO_MSS_RELAY_MSG_BUFFER_08_ADDR A:0x64180020
y.create.l HWIO_MSS_RELAY_MSG_BUFFER_09_ADDR A:0x64180024
y.create.l HWIO_MSS_RELAY_MSG_BUFFER_10_ADDR A:0x64180028
y.create.l HWIO_MSS_RELAY_MSG_BUFFER_11_ADDR A:0x6418002c
y.create.l HWIO_MSS_RELAY_MSG_BUFFER_12_ADDR A:0x64180030
y.create.l HWIO_MSS_RELAY_MSG_BUFFER_13_ADDR A:0x64180034
y.create.l HWIO_MSS_RELAY_MSG_BUFFER_14_ADDR A:0x64180038
y.create.l HWIO_MSS_RELAY_MSG_BUFFER_15_ADDR A:0x6418003c
y.create.l HWIO_MSS_AHB_ACCESS_ERR_IRQ_EN_ADDR A:0x641a8000
y.create.l HWIO_MSS_AHB_ACCESS_ERR_IRQ_STATUS_ADDR A:0x641a8004
y.create.l HWIO_MSS_AHB_ACCESS_ERR_IRQ_CLR_ADDR A:0x641a8008
y.create.l HWIO_MSS_MSA_CRYPTO_ADDR A:0x641a800c
y.create.l HWIO_MSS_MSA_ADDR A:0x641a8010
y.create.l HWIO_MSS_CLOCK_SPDM_MON_ADDR A:0x641a8014
y.create.l HWIO_MSS_DEBUG_CLOCK_CTL_ADDR A:0x641a8018
y.create.l HWIO_MSS_DEBUG_CTL_ADDR A:0x641a801c
y.create.l HWIO_MSS_DBG_BUS_CTL_ADDR A:0x641a8020
y.create.l HWIO_MSS_NAV_AXI_HALTREQ_ADDR A:0x641a8024
y.create.l HWIO_MSS_BIMC_DANGER_ADDR A:0x641a8028
y.create.l HWIO_MSS_HW_VERSION_ADDR A:0x641a802c
y.create.l HWIO_MSS_RELAY_MSG_SHADOW0_ADDR A:0x641a8400
y.create.l HWIO_MSS_RELAY_MSG_SHADOW1_ADDR A:0x641a8404
y.create.l HWIO_MSS_RELAY_MSG_SHADOW2_ADDR A:0x641a8408
y.create.l HWIO_MSS_RELAY_MSG_SHADOW3_ADDR A:0x641a840c
y.create.l HWIO_MSS_RELAY_MSG_SHADOW4_ADDR A:0x641a8410
y.create.l HWIO_MSS_RELAY_MSG_SHADOW5_ADDR A:0x641a8414
y.create.l HWIO_MSS_RELAY_MSG_SHADOW6_ADDR A:0x641a8418
y.create.l HWIO_MSS_RELAY_MSG_SHADOW7_ADDR A:0x641a841c
y.create.l HWIO_MSS_RELAY_MSG_SHADOW8_ADDR A:0x641a8420
y.create.l HWIO_MSS_RELAY_MSG_SHADOW9_ADDR A:0x641a8424
y.create.l HWIO_MSS_RELAY_MSG_SHADOW10_ADDR A:0x641a8428
y.create.l HWIO_MSS_RELAY_MSG_SHADOW11_ADDR A:0x641a842c
y.create.l HWIO_MSS_RELAY_MSG_SHADOW12_ADDR A:0x641a8430
y.create.l HWIO_MSS_RELAY_MSG_SHADOW13_ADDR A:0x641a8434
y.create.l HWIO_MSS_RELAY_MSG_SHADOW14_ADDR A:0x641a8438
y.create.l HWIO_MSS_RELAY_MSG_SHADOW15_ADDR A:0x641a843c
y.create.l HWIO_MSS_OFFLINE_PLL_MODE_ADDR A:0x641a9000
y.create.l HWIO_MSS_OFFLINE_PLL_L_VAL_ADDR A:0x641a9004
y.create.l HWIO_MSS_OFFLINE_PLL_ALPHA_VAL_ADDR A:0x641a9008
y.create.l HWIO_MSS_OFFLINE_PLL_ALPHA_VAL_U_ADDR A:0x641a900c
y.create.l HWIO_MSS_OFFLINE_PLL_USER_CTL_ADDR A:0x641a9010
y.create.l HWIO_MSS_OFFLINE_PLL_USER_CTL_U_ADDR A:0x641a9014
y.create.l HWIO_MSS_OFFLINE_PLL_CONFIG_CTL_ADDR A:0x641a9018
y.create.l HWIO_MSS_OFFLINE_PLL_TEST_CTL_ADDR A:0x641a901c
y.create.l HWIO_MSS_OFFLINE_PLL_TEST_CTL_U_ADDR A:0x641a9020
y.create.l HWIO_MSS_OFFLINE_PLL_STATUS_ADDR A:0x641a9024
y.create.l HWIO_MSS_OFFLINE_PLL_FREQ_CTL_ADDR A:0x641a9028
y.create.l HWIO_MSS_CLAMP_MEM_ADDR A:0x641a902c
y.create.l HWIO_MSS_CLAMP_IO_ADDR A:0x641a9030
y.create.l HWIO_MSS_OFFLINE_MEM_SLP_CNTL_ADDR A:0x641a9034
y.create.l HWIO_MSS_OFFLINE_MEM_SLP_CNTL2_ADDR A:0x641a9038
y.create.l HWIO_MSS_MODEM_BCR_ADDR A:0x641a903c
y.create.l HWIO_MSS_AXI_MNOC_CBCR_ADDR A:0x641a9040
y.create.l HWIO_MSS_XO_MDM_CBCR_ADDR A:0x641a9044
y.create.l HWIO_MSS_BUS_CFG_XO_ADDR A:0x641a9048
y.create.l HWIO_MSS_FABRIC_AXI2AHB_IDLE_ADDR A:0x641a904c
y.create.l HWIO_MSS_OFFLINE_PLL_ODIV_MBIST_CTL_ADDR A:0x641a9050
y.create.l HWIO_MSS_OFFLINE_CLK_CTL_ADDR A:0x641a9054
y.create.l HWIO_MSS_BUS_CMD_RCGR_ADDR A:0x641aa000
y.create.l HWIO_MSS_BUS_CFG_RCGR_ADDR A:0x641aa004
y.create.l HWIO_MSS_UIM_CMD_RCGR_ADDR A:0x641aa008
y.create.l HWIO_MSS_UIM_CFG_RCGR_ADDR A:0x641aa00c
y.create.l HWIO_MSS_UIM0_MND_CMD_RCGR_ADDR A:0x641aa010
y.create.l HWIO_MSS_UIM0_MND_CFG_RCGR_ADDR A:0x641aa014
y.create.l HWIO_MSS_UIM0_MND_M_ADDR A:0x641aa018
y.create.l HWIO_MSS_UIM0_MND_N_ADDR A:0x641aa01c
y.create.l HWIO_MSS_UIM0_MND_D_ADDR A:0x641aa020
y.create.l HWIO_MSS_CARD_SRC_UIM0_CBCR_ADDR A:0x641aa024
y.create.l HWIO_MSS_UART_BIT_UIM0_CBCR_ADDR A:0x641aa028
y.create.l HWIO_MSS_BUS_UIM0_CBCR_ADDR A:0x641aa02c
y.create.l HWIO_MSS_UIM1_MND_CMD_RCGR_ADDR A:0x641aa030
y.create.l HWIO_MSS_UIM1_MND_CFG_RCGR_ADDR A:0x641aa034
y.create.l HWIO_MSS_UIM1_MND_M_ADDR A:0x641aa038
y.create.l HWIO_MSS_UIM1_MND_N_ADDR A:0x641aa03c
y.create.l HWIO_MSS_UIM1_MND_D_ADDR A:0x641aa040
y.create.l HWIO_MSS_CARD_SRC_UIM1_CBCR_ADDR A:0x641aa044
y.create.l HWIO_MSS_UART_BIT_UIM1_CBCR_ADDR A:0x641aa048
y.create.l HWIO_MSS_BUS_UIM1_CBCR_ADDR A:0x641aa04c
y.create.l HWIO_MSS_UIM2_MND_CMD_RCGR_ADDR A:0x641aa050
y.create.l HWIO_MSS_UIM2_MND_CFG_RCGR_ADDR A:0x641aa054
y.create.l HWIO_MSS_UIM2_MND_M_ADDR A:0x641aa058
y.create.l HWIO_MSS_UIM2_MND_N_ADDR A:0x641aa05c
y.create.l HWIO_MSS_UIM2_MND_D_ADDR A:0x641aa060
y.create.l HWIO_MSS_CARD_SRC_UIM2_CBCR_ADDR A:0x641aa064
y.create.l HWIO_MSS_UART_BIT_UIM2_CBCR_ADDR A:0x641aa068
y.create.l HWIO_MSS_BUS_UIM2_CBCR_ADDR A:0x641aa06c
y.create.l HWIO_MSS_UIM3_MND_CMD_RCGR_ADDR A:0x641aa070
y.create.l HWIO_MSS_UIM3_MND_CFG_RCGR_ADDR A:0x641aa074
y.create.l HWIO_MSS_UIM3_MND_M_ADDR A:0x641aa078
y.create.l HWIO_MSS_UIM3_MND_N_ADDR A:0x641aa07c
y.create.l HWIO_MSS_UIM3_MND_D_ADDR A:0x641aa080
y.create.l HWIO_MSS_CARD_SRC_UIM3_CBCR_ADDR A:0x641aa084
y.create.l HWIO_MSS_UART_BIT_UIM3_CBCR_ADDR A:0x641aa088
y.create.l HWIO_MSS_BUS_UIM3_CBCR_ADDR A:0x641aa08c
y.create.l HWIO_MSS_BUS_Q6SS_CBCR_ADDR A:0x641aa090
y.create.l HWIO_MSS_NAV_BCR_ADDR A:0x641aa094
y.create.l HWIO_MSS_BUS_NAV_CBCR_ADDR A:0x641aa098
y.create.l HWIO_MSS_AXI_NAV_CBCR_ADDR A:0x641aa09c
y.create.l HWIO_MSS_XO_NAV_CBCR_ADDR A:0x641aa0a0
y.create.l HWIO_MSS_BUS_CRYPTO_CBCR_ADDR A:0x641aa0a4
y.create.l HWIO_MSS_AXI_CRYPTO_CBCR_ADDR A:0x641aa0a8
y.create.l HWIO_MSS_AXI_DMA_CBCR_ADDR A:0x641aa0ac
y.create.l HWIO_MSS_BIT_COXM_MND_CMD_RCGR_ADDR A:0x641aa0b0
y.create.l HWIO_MSS_BIT_COXM_MND_CFG_RCGR_ADDR A:0x641aa0b4
y.create.l HWIO_MSS_BIT_COXM_MND_M_ADDR A:0x641aa0b8
y.create.l HWIO_MSS_BIT_COXM_MND_N_ADDR A:0x641aa0bc
y.create.l HWIO_MSS_BIT_COXM_MND_D_ADDR A:0x641aa0c0
y.create.l HWIO_MSS_BUS_COXM_CBCR_ADDR A:0x641aa0c4
y.create.l HWIO_MSS_BIT_COXM_CBCR_ADDR A:0x641aa0c8
y.create.l HWIO_MSS_RBCPR_REF_CMD_RCGR_ADDR A:0x641aa0cc
y.create.l HWIO_MSS_RBCPR_REF_CFG_RCGR_ADDR A:0x641aa0d0
y.create.l HWIO_MSS_BUS_RBCPR_CBCR_ADDR A:0x641aa0d4
y.create.l HWIO_MSS_RBCPR_REF_CBCR_ADDR A:0x641aa0d8
y.create.l HWIO_MSS_BUS_MGPI_CBCR_ADDR A:0x641aa0dc
y.create.l HWIO_MSS_BUS_SLAVE_TIMEOUT_CBCR_ADDR A:0x641aa0e0
y.create.l HWIO_MSS_BUS_MVC_CBCR_ADDR A:0x641aa0e4
y.create.l HWIO_MSS_BUS_STMR_CBCR_ADDR A:0x641aa0e8
y.create.l HWIO_MSS_XO_CX_CBCR_ADDR A:0x641aa0ec
y.create.l HWIO_MSS_BUS_RFC_CBCR_ADDR A:0x641aa0f0
y.create.l HWIO_MSS_SW_FEATURE_FUSES_ADDR A:0x641aa0f4
y.create.l HWIO_MSS_SW_FEATURE_FUSES2_ADDR A:0x641aa0f8
y.create.l HWIO_MSS_RESERVE_01_ADDR A:0x641aa0fc
y.create.l HWIO_MSS_RESERVE_02_ADDR A:0x641aa100
y.create.l HWIO_MSS_UIM0_UART_DM_MR1_ADDR A:0x64190000
y.create.l HWIO_MSS_UIM0_UART_DM_MR2_ADDR A:0x64190004
y.create.l HWIO_MSS_UIM0_UART_DM_CSR_SR_DEPRECATED_ADDR A:0x64190008
y.create.l HWIO_MSS_UIM0_UART_DM_CR_MISR_DEPRECATED_ADDR A:0x64190010
y.create.l HWIO_MSS_UIM0_UART_DM_IMR_ISR_DEPRECATED_ADDR A:0x64190014
y.create.l HWIO_MSS_UIM0_UART_DM_IPR_ADDR A:0x64190018
y.create.l HWIO_MSS_UIM0_UART_DM_TFWR_ADDR A:0x6419001c
y.create.l HWIO_MSS_UIM0_UART_DM_RFWR_ADDR A:0x64190020
y.create.l HWIO_MSS_UIM0_UART_DM_HCR_ADDR A:0x64190024
y.create.l HWIO_MSS_UIM0_UART_DM_DMRX_ADDR A:0x64190034
y.create.l HWIO_MSS_UIM0_UART_DM_IRDA_RX_TOTAL_SNAP_DEPRECATED_ADDR A:0x64190038
y.create.l HWIO_MSS_UIM0_UART_DM_DMEN_ADDR A:0x6419003c
y.create.l HWIO_MSS_UIM0_UART_DM_NO_CHARS_FOR_TX_ADDR A:0x64190040
y.create.l HWIO_MSS_UIM0_UART_DM_BADR_ADDR A:0x64190044
y.create.l HWIO_MSS_UIM0_UART_DM_TESTSL_ADDR A:0x64190048
y.create.l HWIO_MSS_UIM0_UART_DM_TXFS_ADDR A:0x6419004c
y.create.l HWIO_MSS_UIM0_UART_DM_RXFS_ADDR A:0x64190050
y.create.l HWIO_MSS_UIM0_UART_DM_MISR_MODE_ADDR A:0x64190060
y.create.l HWIO_MSS_UIM0_UART_DM_MISR_RESET_ADDR A:0x64190064
y.create.l HWIO_MSS_UIM0_UART_DM_MISR_EXPORT_ADDR A:0x64190068
y.create.l HWIO_MSS_UIM0_UART_DM_MISR_VAL_ADDR A:0x6419006c
y.create.l HWIO_MSS_UIM0_UART_DM_TF_RF_DEPRECATED_ADDR A:0x64190070
y.create.l HWIO_MSS_UIM0_UART_DM_TF_RF_2_DEPRECATED_ADDR A:0x64190074
y.create.l HWIO_MSS_UIM0_UART_DM_TF_RF_3_DEPRECATED_ADDR A:0x64190078
y.create.l HWIO_MSS_UIM0_UART_DM_TF_RF_4_DEPRECATED_ADDR A:0x6419007c
y.create.l HWIO_MSS_UIM0_UART_DM_SIM_CFG_ADDR A:0x64190080
y.create.l HWIO_MSS_UIM0_UART_DM_TEST_WR_ADDR_ADDR A:0x64190084
y.create.l HWIO_MSS_UIM0_UART_DM_TEST_WR_DATA_ADDR A:0x64190088
y.create.l HWIO_MSS_UIM0_UART_DM_TEST_RD_ADDR_ADDR A:0x6419008c
y.create.l HWIO_MSS_UIM0_UART_DM_TEST_RD_DATA_ADDR A:0x64190090
y.create.l HWIO_MSS_UIM0_UART_DM_CSR_ADDR A:0x641900a0
y.create.l HWIO_MSS_UIM0_UART_DM_SR_ADDR A:0x641900a4
y.create.l HWIO_MSS_UIM0_UART_DM_CR_ADDR A:0x641900a8
y.create.l HWIO_MSS_UIM0_UART_DM_MISR_ADDR A:0x641900ac
y.create.l HWIO_MSS_UIM0_UART_DM_IMR_ADDR A:0x641900b0
y.create.l HWIO_MSS_UIM0_UART_DM_ISR_ADDR A:0x641900b4
y.create.l HWIO_MSS_UIM0_UART_DM_IRDA_ADDR A:0x641900b8
y.create.l HWIO_MSS_UIM0_UART_DM_RX_TOTAL_SNAP_ADDR A:0x641900bc
y.create.l HWIO_MSS_UIM0_UART_DM_WWT_TIMEOUT_ADDR A:0x641900c0
y.create.l HWIO_MSS_UIM0_UART_DM_CLK_CTRL_ADDR A:0x641900c4
y.create.l HWIO_MSS_UIM0_UART_DM_BCR_ADDR A:0x641900c8
y.create.l HWIO_MSS_UIM0_UART_DM_RX_TRANS_CTRL_ADDR A:0x641900cc
y.create.l HWIO_MSS_UIM0_UART_DM_DMRX_DBG_ADDR A:0x641900d0
y.create.l HWIO_MSS_UIM0_UART_DM_FSM_STATUS_ADDR A:0x641900d4
y.create.l HWIO_MSS_UIM0_UART_DM_HW_VERSION_ADDR A:0x641900d8
y.create.l HWIO_MSS_UIM0_UART_DM_GENERICS_ADDR A:0x641900dc
y.create.l HWIO_MSS_UIM0_UART_DM_TF_ADDR A:0x64190100
y.create.l HWIO_MSS_UIM0_UART_DM_TF_2_ADDR A:0x64190104
y.create.l HWIO_MSS_UIM0_UART_DM_TF_3_ADDR A:0x64190108
y.create.l HWIO_MSS_UIM0_UART_DM_TF_4_ADDR A:0x6419010c
y.create.l HWIO_MSS_UIM0_UART_DM_TF_5_ADDR A:0x64190110
y.create.l HWIO_MSS_UIM0_UART_DM_TF_6_ADDR A:0x64190114
y.create.l HWIO_MSS_UIM0_UART_DM_TF_7_ADDR A:0x64190118
y.create.l HWIO_MSS_UIM0_UART_DM_TF_8_ADDR A:0x6419011c
y.create.l HWIO_MSS_UIM0_UART_DM_TF_9_ADDR A:0x64190120
y.create.l HWIO_MSS_UIM0_UART_DM_TF_10_ADDR A:0x64190124
y.create.l HWIO_MSS_UIM0_UART_DM_TF_11_ADDR A:0x64190128
y.create.l HWIO_MSS_UIM0_UART_DM_TF_12_ADDR A:0x6419012c
y.create.l HWIO_MSS_UIM0_UART_DM_TF_13_ADDR A:0x64190130
y.create.l HWIO_MSS_UIM0_UART_DM_TF_14_ADDR A:0x64190134
y.create.l HWIO_MSS_UIM0_UART_DM_TF_15_ADDR A:0x64190138
y.create.l HWIO_MSS_UIM0_UART_DM_TF_16_ADDR A:0x6419013c
y.create.l HWIO_MSS_UIM0_UART_DM_RF_ADDR A:0x64190140
y.create.l HWIO_MSS_UIM0_UART_DM_RF_2_ADDR A:0x64190144
y.create.l HWIO_MSS_UIM0_UART_DM_RF_3_ADDR A:0x64190148
y.create.l HWIO_MSS_UIM0_UART_DM_RF_4_ADDR A:0x6419014c
y.create.l HWIO_MSS_UIM0_UART_DM_RF_5_ADDR A:0x64190150
y.create.l HWIO_MSS_UIM0_UART_DM_RF_6_ADDR A:0x64190154
y.create.l HWIO_MSS_UIM0_UART_DM_RF_7_ADDR A:0x64190158
y.create.l HWIO_MSS_UIM0_UART_DM_RF_8_ADDR A:0x6419015c
y.create.l HWIO_MSS_UIM0_UART_DM_RF_9_ADDR A:0x64190160
y.create.l HWIO_MSS_UIM0_UART_DM_RF_10_ADDR A:0x64190164
y.create.l HWIO_MSS_UIM0_UART_DM_RF_11_ADDR A:0x64190168
y.create.l HWIO_MSS_UIM0_UART_DM_RF_12_ADDR A:0x6419016c
y.create.l HWIO_MSS_UIM0_UART_DM_RF_13_ADDR A:0x64190170
y.create.l HWIO_MSS_UIM0_UART_DM_RF_14_ADDR A:0x64190174
y.create.l HWIO_MSS_UIM0_UART_DM_RF_15_ADDR A:0x64190178
y.create.l HWIO_MSS_UIM0_UART_DM_RF_16_ADDR A:0x6419017c
y.create.l HWIO_MSS_UIM0_UART_DM_UIM_CFG_ADDR A:0x64190180
y.create.l HWIO_MSS_UIM0_UART_DM_UIM_CMD_ADDR A:0x64190184
y.create.l HWIO_MSS_UIM0_UART_DM_UIM_IO_STATUS_ADDR A:0x64190188
y.create.l HWIO_MSS_UIM0_UART_DM_UIM_IRQ_ISR_ADDR A:0x6419018c
y.create.l HWIO_MSS_UIM0_UART_DM_UIM_IRQ_MISR_ADDR A:0x64190190
y.create.l HWIO_MSS_UIM0_UART_DM_UIM_IRQ_CLR_ADDR A:0x64190194
y.create.l HWIO_MSS_UIM0_UART_DM_UIM_IRQ_IMR_ADDR A:0x64190198
y.create.l HWIO_MSS_UIM0_UART_DM_UIM_IRQ_IMR_SET_ADDR A:0x6419019c
y.create.l HWIO_MSS_UIM0_UART_DM_UIM_IRQ_IMR_CLR_ADDR A:0x641901a0
y.create.l HWIO_MSS_UIM1_UART_DM_MR1_ADDR A:0x64194000
y.create.l HWIO_MSS_UIM1_UART_DM_MR2_ADDR A:0x64194004
y.create.l HWIO_MSS_UIM1_UART_DM_CSR_SR_DEPRECATED_ADDR A:0x64194008
y.create.l HWIO_MSS_UIM1_UART_DM_CR_MISR_DEPRECATED_ADDR A:0x64194010
y.create.l HWIO_MSS_UIM1_UART_DM_IMR_ISR_DEPRECATED_ADDR A:0x64194014
y.create.l HWIO_MSS_UIM1_UART_DM_IPR_ADDR A:0x64194018
y.create.l HWIO_MSS_UIM1_UART_DM_TFWR_ADDR A:0x6419401c
y.create.l HWIO_MSS_UIM1_UART_DM_RFWR_ADDR A:0x64194020
y.create.l HWIO_MSS_UIM1_UART_DM_HCR_ADDR A:0x64194024
y.create.l HWIO_MSS_UIM1_UART_DM_DMRX_ADDR A:0x64194034
y.create.l HWIO_MSS_UIM1_UART_DM_IRDA_RX_TOTAL_SNAP_DEPRECATED_ADDR A:0x64194038
y.create.l HWIO_MSS_UIM1_UART_DM_DMEN_ADDR A:0x6419403c
y.create.l HWIO_MSS_UIM1_UART_DM_NO_CHARS_FOR_TX_ADDR A:0x64194040
y.create.l HWIO_MSS_UIM1_UART_DM_BADR_ADDR A:0x64194044
y.create.l HWIO_MSS_UIM1_UART_DM_TESTSL_ADDR A:0x64194048
y.create.l HWIO_MSS_UIM1_UART_DM_TXFS_ADDR A:0x6419404c
y.create.l HWIO_MSS_UIM1_UART_DM_RXFS_ADDR A:0x64194050
y.create.l HWIO_MSS_UIM1_UART_DM_MISR_MODE_ADDR A:0x64194060
y.create.l HWIO_MSS_UIM1_UART_DM_MISR_RESET_ADDR A:0x64194064
y.create.l HWIO_MSS_UIM1_UART_DM_MISR_EXPORT_ADDR A:0x64194068
y.create.l HWIO_MSS_UIM1_UART_DM_MISR_VAL_ADDR A:0x6419406c
y.create.l HWIO_MSS_UIM1_UART_DM_TF_RF_DEPRECATED_ADDR A:0x64194070
y.create.l HWIO_MSS_UIM1_UART_DM_TF_RF_2_DEPRECATED_ADDR A:0x64194074
y.create.l HWIO_MSS_UIM1_UART_DM_TF_RF_3_DEPRECATED_ADDR A:0x64194078
y.create.l HWIO_MSS_UIM1_UART_DM_TF_RF_4_DEPRECATED_ADDR A:0x6419407c
y.create.l HWIO_MSS_UIM1_UART_DM_SIM_CFG_ADDR A:0x64194080
y.create.l HWIO_MSS_UIM1_UART_DM_TEST_WR_ADDR_ADDR A:0x64194084
y.create.l HWIO_MSS_UIM1_UART_DM_TEST_WR_DATA_ADDR A:0x64194088
y.create.l HWIO_MSS_UIM1_UART_DM_TEST_RD_ADDR_ADDR A:0x6419408c
y.create.l HWIO_MSS_UIM1_UART_DM_TEST_RD_DATA_ADDR A:0x64194090
y.create.l HWIO_MSS_UIM1_UART_DM_CSR_ADDR A:0x641940a0
y.create.l HWIO_MSS_UIM1_UART_DM_SR_ADDR A:0x641940a4
y.create.l HWIO_MSS_UIM1_UART_DM_CR_ADDR A:0x641940a8
y.create.l HWIO_MSS_UIM1_UART_DM_MISR_ADDR A:0x641940ac
y.create.l HWIO_MSS_UIM1_UART_DM_IMR_ADDR A:0x641940b0
y.create.l HWIO_MSS_UIM1_UART_DM_ISR_ADDR A:0x641940b4
y.create.l HWIO_MSS_UIM1_UART_DM_IRDA_ADDR A:0x641940b8
y.create.l HWIO_MSS_UIM1_UART_DM_RX_TOTAL_SNAP_ADDR A:0x641940bc
y.create.l HWIO_MSS_UIM1_UART_DM_WWT_TIMEOUT_ADDR A:0x641940c0
y.create.l HWIO_MSS_UIM1_UART_DM_CLK_CTRL_ADDR A:0x641940c4
y.create.l HWIO_MSS_UIM1_UART_DM_BCR_ADDR A:0x641940c8
y.create.l HWIO_MSS_UIM1_UART_DM_RX_TRANS_CTRL_ADDR A:0x641940cc
y.create.l HWIO_MSS_UIM1_UART_DM_DMRX_DBG_ADDR A:0x641940d0
y.create.l HWIO_MSS_UIM1_UART_DM_FSM_STATUS_ADDR A:0x641940d4
y.create.l HWIO_MSS_UIM1_UART_DM_HW_VERSION_ADDR A:0x641940d8
y.create.l HWIO_MSS_UIM1_UART_DM_GENERICS_ADDR A:0x641940dc
y.create.l HWIO_MSS_UIM1_UART_DM_TF_ADDR A:0x64194100
y.create.l HWIO_MSS_UIM1_UART_DM_TF_2_ADDR A:0x64194104
y.create.l HWIO_MSS_UIM1_UART_DM_TF_3_ADDR A:0x64194108
y.create.l HWIO_MSS_UIM1_UART_DM_TF_4_ADDR A:0x6419410c
y.create.l HWIO_MSS_UIM1_UART_DM_TF_5_ADDR A:0x64194110
y.create.l HWIO_MSS_UIM1_UART_DM_TF_6_ADDR A:0x64194114
y.create.l HWIO_MSS_UIM1_UART_DM_TF_7_ADDR A:0x64194118
y.create.l HWIO_MSS_UIM1_UART_DM_TF_8_ADDR A:0x6419411c
y.create.l HWIO_MSS_UIM1_UART_DM_TF_9_ADDR A:0x64194120
y.create.l HWIO_MSS_UIM1_UART_DM_TF_10_ADDR A:0x64194124
y.create.l HWIO_MSS_UIM1_UART_DM_TF_11_ADDR A:0x64194128
y.create.l HWIO_MSS_UIM1_UART_DM_TF_12_ADDR A:0x6419412c
y.create.l HWIO_MSS_UIM1_UART_DM_TF_13_ADDR A:0x64194130
y.create.l HWIO_MSS_UIM1_UART_DM_TF_14_ADDR A:0x64194134
y.create.l HWIO_MSS_UIM1_UART_DM_TF_15_ADDR A:0x64194138
y.create.l HWIO_MSS_UIM1_UART_DM_TF_16_ADDR A:0x6419413c
y.create.l HWIO_MSS_UIM1_UART_DM_RF_ADDR A:0x64194140
y.create.l HWIO_MSS_UIM1_UART_DM_RF_2_ADDR A:0x64194144
y.create.l HWIO_MSS_UIM1_UART_DM_RF_3_ADDR A:0x64194148
y.create.l HWIO_MSS_UIM1_UART_DM_RF_4_ADDR A:0x6419414c
y.create.l HWIO_MSS_UIM1_UART_DM_RF_5_ADDR A:0x64194150
y.create.l HWIO_MSS_UIM1_UART_DM_RF_6_ADDR A:0x64194154
y.create.l HWIO_MSS_UIM1_UART_DM_RF_7_ADDR A:0x64194158
y.create.l HWIO_MSS_UIM1_UART_DM_RF_8_ADDR A:0x6419415c
y.create.l HWIO_MSS_UIM1_UART_DM_RF_9_ADDR A:0x64194160
y.create.l HWIO_MSS_UIM1_UART_DM_RF_10_ADDR A:0x64194164
y.create.l HWIO_MSS_UIM1_UART_DM_RF_11_ADDR A:0x64194168
y.create.l HWIO_MSS_UIM1_UART_DM_RF_12_ADDR A:0x6419416c
y.create.l HWIO_MSS_UIM1_UART_DM_RF_13_ADDR A:0x64194170
y.create.l HWIO_MSS_UIM1_UART_DM_RF_14_ADDR A:0x64194174
y.create.l HWIO_MSS_UIM1_UART_DM_RF_15_ADDR A:0x64194178
y.create.l HWIO_MSS_UIM1_UART_DM_RF_16_ADDR A:0x6419417c
y.create.l HWIO_MSS_UIM1_UART_DM_UIM_CFG_ADDR A:0x64194180
y.create.l HWIO_MSS_UIM1_UART_DM_UIM_CMD_ADDR A:0x64194184
y.create.l HWIO_MSS_UIM1_UART_DM_UIM_IO_STATUS_ADDR A:0x64194188
y.create.l HWIO_MSS_UIM1_UART_DM_UIM_IRQ_ISR_ADDR A:0x6419418c
y.create.l HWIO_MSS_UIM1_UART_DM_UIM_IRQ_MISR_ADDR A:0x64194190
y.create.l HWIO_MSS_UIM1_UART_DM_UIM_IRQ_CLR_ADDR A:0x64194194
y.create.l HWIO_MSS_UIM1_UART_DM_UIM_IRQ_IMR_ADDR A:0x64194198
y.create.l HWIO_MSS_UIM1_UART_DM_UIM_IRQ_IMR_SET_ADDR A:0x6419419c
y.create.l HWIO_MSS_UIM1_UART_DM_UIM_IRQ_IMR_CLR_ADDR A:0x641941a0
y.create.l HWIO_MSS_UIM2_UART_DM_MR1_ADDR A:0x64198000
y.create.l HWIO_MSS_UIM2_UART_DM_MR2_ADDR A:0x64198004
y.create.l HWIO_MSS_UIM2_UART_DM_CSR_SR_DEPRECATED_ADDR A:0x64198008
y.create.l HWIO_MSS_UIM2_UART_DM_CR_MISR_DEPRECATED_ADDR A:0x64198010
y.create.l HWIO_MSS_UIM2_UART_DM_IMR_ISR_DEPRECATED_ADDR A:0x64198014
y.create.l HWIO_MSS_UIM2_UART_DM_IPR_ADDR A:0x64198018
y.create.l HWIO_MSS_UIM2_UART_DM_TFWR_ADDR A:0x6419801c
y.create.l HWIO_MSS_UIM2_UART_DM_RFWR_ADDR A:0x64198020
y.create.l HWIO_MSS_UIM2_UART_DM_HCR_ADDR A:0x64198024
y.create.l HWIO_MSS_UIM2_UART_DM_DMRX_ADDR A:0x64198034
y.create.l HWIO_MSS_UIM2_UART_DM_IRDA_RX_TOTAL_SNAP_DEPRECATED_ADDR A:0x64198038
y.create.l HWIO_MSS_UIM2_UART_DM_DMEN_ADDR A:0x6419803c
y.create.l HWIO_MSS_UIM2_UART_DM_NO_CHARS_FOR_TX_ADDR A:0x64198040
y.create.l HWIO_MSS_UIM2_UART_DM_BADR_ADDR A:0x64198044
y.create.l HWIO_MSS_UIM2_UART_DM_TESTSL_ADDR A:0x64198048
y.create.l HWIO_MSS_UIM2_UART_DM_TXFS_ADDR A:0x6419804c
y.create.l HWIO_MSS_UIM2_UART_DM_RXFS_ADDR A:0x64198050
y.create.l HWIO_MSS_UIM2_UART_DM_MISR_MODE_ADDR A:0x64198060
y.create.l HWIO_MSS_UIM2_UART_DM_MISR_RESET_ADDR A:0x64198064
y.create.l HWIO_MSS_UIM2_UART_DM_MISR_EXPORT_ADDR A:0x64198068
y.create.l HWIO_MSS_UIM2_UART_DM_MISR_VAL_ADDR A:0x6419806c
y.create.l HWIO_MSS_UIM2_UART_DM_TF_RF_DEPRECATED_ADDR A:0x64198070
y.create.l HWIO_MSS_UIM2_UART_DM_TF_RF_2_DEPRECATED_ADDR A:0x64198074
y.create.l HWIO_MSS_UIM2_UART_DM_TF_RF_3_DEPRECATED_ADDR A:0x64198078
y.create.l HWIO_MSS_UIM2_UART_DM_TF_RF_4_DEPRECATED_ADDR A:0x6419807c
y.create.l HWIO_MSS_UIM2_UART_DM_SIM_CFG_ADDR A:0x64198080
y.create.l HWIO_MSS_UIM2_UART_DM_TEST_WR_ADDR_ADDR A:0x64198084
y.create.l HWIO_MSS_UIM2_UART_DM_TEST_WR_DATA_ADDR A:0x64198088
y.create.l HWIO_MSS_UIM2_UART_DM_TEST_RD_ADDR_ADDR A:0x6419808c
y.create.l HWIO_MSS_UIM2_UART_DM_TEST_RD_DATA_ADDR A:0x64198090
y.create.l HWIO_MSS_UIM2_UART_DM_CSR_ADDR A:0x641980a0
y.create.l HWIO_MSS_UIM2_UART_DM_SR_ADDR A:0x641980a4
y.create.l HWIO_MSS_UIM2_UART_DM_CR_ADDR A:0x641980a8
y.create.l HWIO_MSS_UIM2_UART_DM_MISR_ADDR A:0x641980ac
y.create.l HWIO_MSS_UIM2_UART_DM_IMR_ADDR A:0x641980b0
y.create.l HWIO_MSS_UIM2_UART_DM_ISR_ADDR A:0x641980b4
y.create.l HWIO_MSS_UIM2_UART_DM_IRDA_ADDR A:0x641980b8
y.create.l HWIO_MSS_UIM2_UART_DM_RX_TOTAL_SNAP_ADDR A:0x641980bc
y.create.l HWIO_MSS_UIM2_UART_DM_WWT_TIMEOUT_ADDR A:0x641980c0
y.create.l HWIO_MSS_UIM2_UART_DM_CLK_CTRL_ADDR A:0x641980c4
y.create.l HWIO_MSS_UIM2_UART_DM_BCR_ADDR A:0x641980c8
y.create.l HWIO_MSS_UIM2_UART_DM_RX_TRANS_CTRL_ADDR A:0x641980cc
y.create.l HWIO_MSS_UIM2_UART_DM_DMRX_DBG_ADDR A:0x641980d0
y.create.l HWIO_MSS_UIM2_UART_DM_FSM_STATUS_ADDR A:0x641980d4
y.create.l HWIO_MSS_UIM2_UART_DM_HW_VERSION_ADDR A:0x641980d8
y.create.l HWIO_MSS_UIM2_UART_DM_GENERICS_ADDR A:0x641980dc
y.create.l HWIO_MSS_UIM2_UART_DM_TF_ADDR A:0x64198100
y.create.l HWIO_MSS_UIM2_UART_DM_TF_2_ADDR A:0x64198104
y.create.l HWIO_MSS_UIM2_UART_DM_TF_3_ADDR A:0x64198108
y.create.l HWIO_MSS_UIM2_UART_DM_TF_4_ADDR A:0x6419810c
y.create.l HWIO_MSS_UIM2_UART_DM_TF_5_ADDR A:0x64198110
y.create.l HWIO_MSS_UIM2_UART_DM_TF_6_ADDR A:0x64198114
y.create.l HWIO_MSS_UIM2_UART_DM_TF_7_ADDR A:0x64198118
y.create.l HWIO_MSS_UIM2_UART_DM_TF_8_ADDR A:0x6419811c
y.create.l HWIO_MSS_UIM2_UART_DM_TF_9_ADDR A:0x64198120
y.create.l HWIO_MSS_UIM2_UART_DM_TF_10_ADDR A:0x64198124
y.create.l HWIO_MSS_UIM2_UART_DM_TF_11_ADDR A:0x64198128
y.create.l HWIO_MSS_UIM2_UART_DM_TF_12_ADDR A:0x6419812c
y.create.l HWIO_MSS_UIM2_UART_DM_TF_13_ADDR A:0x64198130
y.create.l HWIO_MSS_UIM2_UART_DM_TF_14_ADDR A:0x64198134
y.create.l HWIO_MSS_UIM2_UART_DM_TF_15_ADDR A:0x64198138
y.create.l HWIO_MSS_UIM2_UART_DM_TF_16_ADDR A:0x6419813c
y.create.l HWIO_MSS_UIM2_UART_DM_RF_ADDR A:0x64198140
y.create.l HWIO_MSS_UIM2_UART_DM_RF_2_ADDR A:0x64198144
y.create.l HWIO_MSS_UIM2_UART_DM_RF_3_ADDR A:0x64198148
y.create.l HWIO_MSS_UIM2_UART_DM_RF_4_ADDR A:0x6419814c
y.create.l HWIO_MSS_UIM2_UART_DM_RF_5_ADDR A:0x64198150
y.create.l HWIO_MSS_UIM2_UART_DM_RF_6_ADDR A:0x64198154
y.create.l HWIO_MSS_UIM2_UART_DM_RF_7_ADDR A:0x64198158
y.create.l HWIO_MSS_UIM2_UART_DM_RF_8_ADDR A:0x6419815c
y.create.l HWIO_MSS_UIM2_UART_DM_RF_9_ADDR A:0x64198160
y.create.l HWIO_MSS_UIM2_UART_DM_RF_10_ADDR A:0x64198164
y.create.l HWIO_MSS_UIM2_UART_DM_RF_11_ADDR A:0x64198168
y.create.l HWIO_MSS_UIM2_UART_DM_RF_12_ADDR A:0x6419816c
y.create.l HWIO_MSS_UIM2_UART_DM_RF_13_ADDR A:0x64198170
y.create.l HWIO_MSS_UIM2_UART_DM_RF_14_ADDR A:0x64198174
y.create.l HWIO_MSS_UIM2_UART_DM_RF_15_ADDR A:0x64198178
y.create.l HWIO_MSS_UIM2_UART_DM_RF_16_ADDR A:0x6419817c
y.create.l HWIO_MSS_UIM2_UART_DM_UIM_CFG_ADDR A:0x64198180
y.create.l HWIO_MSS_UIM2_UART_DM_UIM_CMD_ADDR A:0x64198184
y.create.l HWIO_MSS_UIM2_UART_DM_UIM_IO_STATUS_ADDR A:0x64198188
y.create.l HWIO_MSS_UIM2_UART_DM_UIM_IRQ_ISR_ADDR A:0x6419818c
y.create.l HWIO_MSS_UIM2_UART_DM_UIM_IRQ_MISR_ADDR A:0x64198190
y.create.l HWIO_MSS_UIM2_UART_DM_UIM_IRQ_CLR_ADDR A:0x64198194
y.create.l HWIO_MSS_UIM2_UART_DM_UIM_IRQ_IMR_ADDR A:0x64198198
y.create.l HWIO_MSS_UIM2_UART_DM_UIM_IRQ_IMR_SET_ADDR A:0x6419819c
y.create.l HWIO_MSS_UIM2_UART_DM_UIM_IRQ_IMR_CLR_ADDR A:0x641981a0
y.create.l HWIO_MSS_UIM3_UART_DM_MR1_ADDR A:0x6419c000
y.create.l HWIO_MSS_UIM3_UART_DM_MR2_ADDR A:0x6419c004
y.create.l HWIO_MSS_UIM3_UART_DM_CSR_SR_DEPRECATED_ADDR A:0x6419c008
y.create.l HWIO_MSS_UIM3_UART_DM_CR_MISR_DEPRECATED_ADDR A:0x6419c010
y.create.l HWIO_MSS_UIM3_UART_DM_IMR_ISR_DEPRECATED_ADDR A:0x6419c014
y.create.l HWIO_MSS_UIM3_UART_DM_IPR_ADDR A:0x6419c018
y.create.l HWIO_MSS_UIM3_UART_DM_TFWR_ADDR A:0x6419c01c
y.create.l HWIO_MSS_UIM3_UART_DM_RFWR_ADDR A:0x6419c020
y.create.l HWIO_MSS_UIM3_UART_DM_HCR_ADDR A:0x6419c024
y.create.l HWIO_MSS_UIM3_UART_DM_DMRX_ADDR A:0x6419c034
y.create.l HWIO_MSS_UIM3_UART_DM_IRDA_RX_TOTAL_SNAP_DEPRECATED_ADDR A:0x6419c038
y.create.l HWIO_MSS_UIM3_UART_DM_DMEN_ADDR A:0x6419c03c
y.create.l HWIO_MSS_UIM3_UART_DM_NO_CHARS_FOR_TX_ADDR A:0x6419c040
y.create.l HWIO_MSS_UIM3_UART_DM_BADR_ADDR A:0x6419c044
y.create.l HWIO_MSS_UIM3_UART_DM_TESTSL_ADDR A:0x6419c048
y.create.l HWIO_MSS_UIM3_UART_DM_TXFS_ADDR A:0x6419c04c
y.create.l HWIO_MSS_UIM3_UART_DM_RXFS_ADDR A:0x6419c050
y.create.l HWIO_MSS_UIM3_UART_DM_MISR_MODE_ADDR A:0x6419c060
y.create.l HWIO_MSS_UIM3_UART_DM_MISR_RESET_ADDR A:0x6419c064
y.create.l HWIO_MSS_UIM3_UART_DM_MISR_EXPORT_ADDR A:0x6419c068
y.create.l HWIO_MSS_UIM3_UART_DM_MISR_VAL_ADDR A:0x6419c06c
y.create.l HWIO_MSS_UIM3_UART_DM_TF_RF_DEPRECATED_ADDR A:0x6419c070
y.create.l HWIO_MSS_UIM3_UART_DM_TF_RF_2_DEPRECATED_ADDR A:0x6419c074
y.create.l HWIO_MSS_UIM3_UART_DM_TF_RF_3_DEPRECATED_ADDR A:0x6419c078
y.create.l HWIO_MSS_UIM3_UART_DM_TF_RF_4_DEPRECATED_ADDR A:0x6419c07c
y.create.l HWIO_MSS_UIM3_UART_DM_SIM_CFG_ADDR A:0x6419c080
y.create.l HWIO_MSS_UIM3_UART_DM_TEST_WR_ADDR_ADDR A:0x6419c084
y.create.l HWIO_MSS_UIM3_UART_DM_TEST_WR_DATA_ADDR A:0x6419c088
y.create.l HWIO_MSS_UIM3_UART_DM_TEST_RD_ADDR_ADDR A:0x6419c08c
y.create.l HWIO_MSS_UIM3_UART_DM_TEST_RD_DATA_ADDR A:0x6419c090
y.create.l HWIO_MSS_UIM3_UART_DM_CSR_ADDR A:0x6419c0a0
y.create.l HWIO_MSS_UIM3_UART_DM_SR_ADDR A:0x6419c0a4
y.create.l HWIO_MSS_UIM3_UART_DM_CR_ADDR A:0x6419c0a8
y.create.l HWIO_MSS_UIM3_UART_DM_MISR_ADDR A:0x6419c0ac
y.create.l HWIO_MSS_UIM3_UART_DM_IMR_ADDR A:0x6419c0b0
y.create.l HWIO_MSS_UIM3_UART_DM_ISR_ADDR A:0x6419c0b4
y.create.l HWIO_MSS_UIM3_UART_DM_IRDA_ADDR A:0x6419c0b8
y.create.l HWIO_MSS_UIM3_UART_DM_RX_TOTAL_SNAP_ADDR A:0x6419c0bc
y.create.l HWIO_MSS_UIM3_UART_DM_WWT_TIMEOUT_ADDR A:0x6419c0c0
y.create.l HWIO_MSS_UIM3_UART_DM_CLK_CTRL_ADDR A:0x6419c0c4
y.create.l HWIO_MSS_UIM3_UART_DM_BCR_ADDR A:0x6419c0c8
y.create.l HWIO_MSS_UIM3_UART_DM_RX_TRANS_CTRL_ADDR A:0x6419c0cc
y.create.l HWIO_MSS_UIM3_UART_DM_DMRX_DBG_ADDR A:0x6419c0d0
y.create.l HWIO_MSS_UIM3_UART_DM_FSM_STATUS_ADDR A:0x6419c0d4
y.create.l HWIO_MSS_UIM3_UART_DM_HW_VERSION_ADDR A:0x6419c0d8
y.create.l HWIO_MSS_UIM3_UART_DM_GENERICS_ADDR A:0x6419c0dc
y.create.l HWIO_MSS_UIM3_UART_DM_TF_ADDR A:0x6419c100
y.create.l HWIO_MSS_UIM3_UART_DM_TF_2_ADDR A:0x6419c104
y.create.l HWIO_MSS_UIM3_UART_DM_TF_3_ADDR A:0x6419c108
y.create.l HWIO_MSS_UIM3_UART_DM_TF_4_ADDR A:0x6419c10c
y.create.l HWIO_MSS_UIM3_UART_DM_TF_5_ADDR A:0x6419c110
y.create.l HWIO_MSS_UIM3_UART_DM_TF_6_ADDR A:0x6419c114
y.create.l HWIO_MSS_UIM3_UART_DM_TF_7_ADDR A:0x6419c118
y.create.l HWIO_MSS_UIM3_UART_DM_TF_8_ADDR A:0x6419c11c
y.create.l HWIO_MSS_UIM3_UART_DM_TF_9_ADDR A:0x6419c120
y.create.l HWIO_MSS_UIM3_UART_DM_TF_10_ADDR A:0x6419c124
y.create.l HWIO_MSS_UIM3_UART_DM_TF_11_ADDR A:0x6419c128
y.create.l HWIO_MSS_UIM3_UART_DM_TF_12_ADDR A:0x6419c12c
y.create.l HWIO_MSS_UIM3_UART_DM_TF_13_ADDR A:0x6419c130
y.create.l HWIO_MSS_UIM3_UART_DM_TF_14_ADDR A:0x6419c134
y.create.l HWIO_MSS_UIM3_UART_DM_TF_15_ADDR A:0x6419c138
y.create.l HWIO_MSS_UIM3_UART_DM_TF_16_ADDR A:0x6419c13c
y.create.l HWIO_MSS_UIM3_UART_DM_RF_ADDR A:0x6419c140
y.create.l HWIO_MSS_UIM3_UART_DM_RF_2_ADDR A:0x6419c144
y.create.l HWIO_MSS_UIM3_UART_DM_RF_3_ADDR A:0x6419c148
y.create.l HWIO_MSS_UIM3_UART_DM_RF_4_ADDR A:0x6419c14c
y.create.l HWIO_MSS_UIM3_UART_DM_RF_5_ADDR A:0x6419c150
y.create.l HWIO_MSS_UIM3_UART_DM_RF_6_ADDR A:0x6419c154
y.create.l HWIO_MSS_UIM3_UART_DM_RF_7_ADDR A:0x6419c158
y.create.l HWIO_MSS_UIM3_UART_DM_RF_8_ADDR A:0x6419c15c
y.create.l HWIO_MSS_UIM3_UART_DM_RF_9_ADDR A:0x6419c160
y.create.l HWIO_MSS_UIM3_UART_DM_RF_10_ADDR A:0x6419c164
y.create.l HWIO_MSS_UIM3_UART_DM_RF_11_ADDR A:0x6419c168
y.create.l HWIO_MSS_UIM3_UART_DM_RF_12_ADDR A:0x6419c16c
y.create.l HWIO_MSS_UIM3_UART_DM_RF_13_ADDR A:0x6419c170
y.create.l HWIO_MSS_UIM3_UART_DM_RF_14_ADDR A:0x6419c174
y.create.l HWIO_MSS_UIM3_UART_DM_RF_15_ADDR A:0x6419c178
y.create.l HWIO_MSS_UIM3_UART_DM_RF_16_ADDR A:0x6419c17c
y.create.l HWIO_MSS_UIM3_UART_DM_UIM_CFG_ADDR A:0x6419c180
y.create.l HWIO_MSS_UIM3_UART_DM_UIM_CMD_ADDR A:0x6419c184
y.create.l HWIO_MSS_UIM3_UART_DM_UIM_IO_STATUS_ADDR A:0x6419c188
y.create.l HWIO_MSS_UIM3_UART_DM_UIM_IRQ_ISR_ADDR A:0x6419c18c
y.create.l HWIO_MSS_UIM3_UART_DM_UIM_IRQ_MISR_ADDR A:0x6419c190
y.create.l HWIO_MSS_UIM3_UART_DM_UIM_IRQ_CLR_ADDR A:0x6419c194
y.create.l HWIO_MSS_UIM3_UART_DM_UIM_IRQ_IMR_ADDR A:0x6419c198
y.create.l HWIO_MSS_UIM3_UART_DM_UIM_IRQ_IMR_SET_ADDR A:0x6419c19c
y.create.l HWIO_MSS_UIM3_UART_DM_UIM_IRQ_IMR_CLR_ADDR A:0x6419c1a0
y.create.l HWIO_MSS_CXM_UART_DM_MR1_ADDR A:0x641a0000
y.create.l HWIO_MSS_CXM_UART_DM_MR2_ADDR A:0x641a0004
y.create.l HWIO_MSS_CXM_UART_DM_CSR_SR_DEPRECATED_ADDR A:0x641a0008
y.create.l HWIO_MSS_CXM_UART_DM_CR_MISR_DEPRECATED_ADDR A:0x641a0010
y.create.l HWIO_MSS_CXM_UART_DM_IMR_ISR_DEPRECATED_ADDR A:0x641a0014
y.create.l HWIO_MSS_CXM_UART_DM_IPR_ADDR A:0x641a0018
y.create.l HWIO_MSS_CXM_UART_DM_TFWR_ADDR A:0x641a001c
y.create.l HWIO_MSS_CXM_UART_DM_RFWR_ADDR A:0x641a0020
y.create.l HWIO_MSS_CXM_UART_DM_HCR_ADDR A:0x641a0024
y.create.l HWIO_MSS_CXM_UART_DM_DMRX_ADDR A:0x641a0034
y.create.l HWIO_MSS_CXM_UART_DM_IRDA_RX_TOTAL_SNAP_DEPRECATED_ADDR A:0x641a0038
y.create.l HWIO_MSS_CXM_UART_DM_DMEN_ADDR A:0x641a003c
y.create.l HWIO_MSS_CXM_UART_DM_NO_CHARS_FOR_TX_ADDR A:0x641a0040
y.create.l HWIO_MSS_CXM_UART_DM_BADR_ADDR A:0x641a0044
y.create.l HWIO_MSS_CXM_UART_DM_TESTSL_ADDR A:0x641a0048
y.create.l HWIO_MSS_CXM_UART_DM_TXFS_ADDR A:0x641a004c
y.create.l HWIO_MSS_CXM_UART_DM_RXFS_ADDR A:0x641a0050
y.create.l HWIO_MSS_CXM_UART_DM_MISR_MODE_ADDR A:0x641a0060
y.create.l HWIO_MSS_CXM_UART_DM_MISR_RESET_ADDR A:0x641a0064
y.create.l HWIO_MSS_CXM_UART_DM_MISR_EXPORT_ADDR A:0x641a0068
y.create.l HWIO_MSS_CXM_UART_DM_MISR_VAL_ADDR A:0x641a006c
y.create.l HWIO_MSS_CXM_UART_DM_TF_RF_DEPRECATED_ADDR A:0x641a0070
y.create.l HWIO_MSS_CXM_UART_DM_TF_RF_2_DEPRECATED_ADDR A:0x641a0074
y.create.l HWIO_MSS_CXM_UART_DM_TF_RF_3_DEPRECATED_ADDR A:0x641a0078
y.create.l HWIO_MSS_CXM_UART_DM_TF_RF_4_DEPRECATED_ADDR A:0x641a007c
y.create.l HWIO_MSS_CXM_UART_DM_SIM_CFG_ADDR A:0x641a0080
y.create.l HWIO_MSS_CXM_UART_DM_TEST_WR_ADDR_ADDR A:0x641a0084
y.create.l HWIO_MSS_CXM_UART_DM_TEST_WR_DATA_ADDR A:0x641a0088
y.create.l HWIO_MSS_CXM_UART_DM_TEST_RD_ADDR_ADDR A:0x641a008c
y.create.l HWIO_MSS_CXM_UART_DM_TEST_RD_DATA_ADDR A:0x641a0090
y.create.l HWIO_MSS_CXM_UART_DM_CSR_ADDR A:0x641a00a0
y.create.l HWIO_MSS_CXM_UART_DM_SR_ADDR A:0x641a00a4
y.create.l HWIO_MSS_CXM_UART_DM_CR_ADDR A:0x641a00a8
y.create.l HWIO_MSS_CXM_UART_DM_MISR_ADDR A:0x641a00ac
y.create.l HWIO_MSS_CXM_UART_DM_IMR_ADDR A:0x641a00b0
y.create.l HWIO_MSS_CXM_UART_DM_ISR_ADDR A:0x641a00b4
y.create.l HWIO_MSS_CXM_UART_DM_IRDA_ADDR A:0x641a00b8
y.create.l HWIO_MSS_CXM_UART_DM_RX_TOTAL_SNAP_ADDR A:0x641a00bc
y.create.l HWIO_MSS_CXM_UART_DM_WWT_TIMEOUT_ADDR A:0x641a00c0
y.create.l HWIO_MSS_CXM_UART_DM_CLK_CTRL_ADDR A:0x641a00c4
y.create.l HWIO_MSS_CXM_UART_DM_BCR_ADDR A:0x641a00c8
y.create.l HWIO_MSS_CXM_UART_DM_RX_TRANS_CTRL_ADDR A:0x641a00cc
y.create.l HWIO_MSS_CXM_UART_DM_DMRX_DBG_ADDR A:0x641a00d0
y.create.l HWIO_MSS_CXM_UART_DM_FSM_STATUS_ADDR A:0x641a00d4
y.create.l HWIO_MSS_CXM_UART_DM_HW_VERSION_ADDR A:0x641a00d8
y.create.l HWIO_MSS_CXM_UART_DM_GENERICS_ADDR A:0x641a00dc
y.create.l HWIO_MSS_CXM_UART_DM_TF_ADDR A:0x641a0100
y.create.l HWIO_MSS_CXM_UART_DM_TF_2_ADDR A:0x641a0104
y.create.l HWIO_MSS_CXM_UART_DM_TF_3_ADDR A:0x641a0108
y.create.l HWIO_MSS_CXM_UART_DM_TF_4_ADDR A:0x641a010c
y.create.l HWIO_MSS_CXM_UART_DM_TF_5_ADDR A:0x641a0110
y.create.l HWIO_MSS_CXM_UART_DM_TF_6_ADDR A:0x641a0114
y.create.l HWIO_MSS_CXM_UART_DM_TF_7_ADDR A:0x641a0118
y.create.l HWIO_MSS_CXM_UART_DM_TF_8_ADDR A:0x641a011c
y.create.l HWIO_MSS_CXM_UART_DM_TF_9_ADDR A:0x641a0120
y.create.l HWIO_MSS_CXM_UART_DM_TF_10_ADDR A:0x641a0124
y.create.l HWIO_MSS_CXM_UART_DM_TF_11_ADDR A:0x641a0128
y.create.l HWIO_MSS_CXM_UART_DM_TF_12_ADDR A:0x641a012c
y.create.l HWIO_MSS_CXM_UART_DM_TF_13_ADDR A:0x641a0130
y.create.l HWIO_MSS_CXM_UART_DM_TF_14_ADDR A:0x641a0134
y.create.l HWIO_MSS_CXM_UART_DM_TF_15_ADDR A:0x641a0138
y.create.l HWIO_MSS_CXM_UART_DM_TF_16_ADDR A:0x641a013c
y.create.l HWIO_MSS_CXM_UART_DM_RF_ADDR A:0x641a0140
y.create.l HWIO_MSS_CXM_UART_DM_RF_2_ADDR A:0x641a0144
y.create.l HWIO_MSS_CXM_UART_DM_RF_3_ADDR A:0x641a0148
y.create.l HWIO_MSS_CXM_UART_DM_RF_4_ADDR A:0x641a014c
y.create.l HWIO_MSS_CXM_UART_DM_RF_5_ADDR A:0x641a0150
y.create.l HWIO_MSS_CXM_UART_DM_RF_6_ADDR A:0x641a0154
y.create.l HWIO_MSS_CXM_UART_DM_RF_7_ADDR A:0x641a0158
y.create.l HWIO_MSS_CXM_UART_DM_RF_8_ADDR A:0x641a015c
y.create.l HWIO_MSS_CXM_UART_DM_RF_9_ADDR A:0x641a0160
y.create.l HWIO_MSS_CXM_UART_DM_RF_10_ADDR A:0x641a0164
y.create.l HWIO_MSS_CXM_UART_DM_RF_11_ADDR A:0x641a0168
y.create.l HWIO_MSS_CXM_UART_DM_RF_12_ADDR A:0x641a016c
y.create.l HWIO_MSS_CXM_UART_DM_RF_13_ADDR A:0x641a0170
y.create.l HWIO_MSS_CXM_UART_DM_RF_14_ADDR A:0x641a0174
y.create.l HWIO_MSS_CXM_UART_DM_RF_15_ADDR A:0x641a0178
y.create.l HWIO_MSS_CXM_UART_DM_RF_16_ADDR A:0x641a017c
y.create.l HWIO_MSS_CXM_UART_DM_UIM_CFG_ADDR A:0x641a0180
y.create.l HWIO_MSS_CXM_UART_DM_UIM_CMD_ADDR A:0x641a0184
y.create.l HWIO_MSS_CXM_UART_DM_UIM_IO_STATUS_ADDR A:0x641a0188
y.create.l HWIO_MSS_CXM_UART_DM_UIM_IRQ_ISR_ADDR A:0x641a018c
y.create.l HWIO_MSS_CXM_UART_DM_UIM_IRQ_MISR_ADDR A:0x641a0190
y.create.l HWIO_MSS_CXM_UART_DM_UIM_IRQ_CLR_ADDR A:0x641a0194
y.create.l HWIO_MSS_CXM_UART_DM_UIM_IRQ_IMR_ADDR A:0x641a0198
y.create.l HWIO_MSS_CXM_UART_DM_UIM_IRQ_IMR_SET_ADDR A:0x641a019c
y.create.l HWIO_MSS_CXM_UART_DM_UIM_IRQ_IMR_CLR_ADDR A:0x641a01a0
y.create.l HWIO_MSS_CXM_CONFIG_ADDR A:0x641a01a4
y.create.l HWIO_MSS_CXM_TX_CONFIG_ADDR A:0x641a01a8
y.create.l HWIO_MSS_CXM_RX_STAT_ADDR A:0x641a01ac
y.create.l HWIO_MSS_CXM_DBG_STAT_ADDR A:0x641a01b0
y.create.l HWIO_MSS_CXM_DIR_UART_TR_ADDR A:0x641a01b4
y.create.l HWIO_MSS_CXM_TYP0_RESP_TOUT_DUR_ADDR A:0x641a01b8
y.create.l HWIO_MSS_CXM_TYP0_RESP_STAT_ADDR A:0x641a01bc
y.create.l HWIO_MSS_CXM_WCN_PRIORITY_REG_STAT_ADDR A:0x641a01c0
y.create.l HWIO_MSS_CXM_RX_WCI2_MSG_TYPE0_CONTENT_ADDR A:0x641a01c4
y.create.l HWIO_MSS_CXM_RX_WCI2_MSG_TYPE1_CONTENT_ADDR A:0x641a01c8
y.create.l HWIO_MSS_CXM_RX_WCI2_MSG_TYPE2_CONTENT_ADDR A:0x641a01cc
y.create.l HWIO_MSS_CXM_RX_WCI2_MSG_TYPE3_CONTENT_ADDR A:0x641a01d0
y.create.l HWIO_MSS_CXM_RX_WCI2_MSG_TYPE4_CONTENT_ADDR A:0x641a01d4
y.create.l HWIO_MSS_CXM_RX_WCI2_MSG_TYPE5_CONTENT_ADDR A:0x641a01d8
y.create.l HWIO_MSS_CXM_RX_WCI2_MSG_TYPE6_CONTENT_ADDR A:0x641a01dc
y.create.l HWIO_MSS_CXM_RX_WCI2_MSG_TYPE7_CONTENT_ADDR A:0x641a01e0
y.create.l HWIO_MSS_CXM_SPARE_BITS_ADDR A:0x641a01e4
y.create.l HWIO_MSS_CONF_ABT_HW_VERSION_ADDR A:0x641b0000
y.create.l HWIO_MSS_CONF_ABT_INST_ID_ADDR A:0x641b0004
y.create.l HWIO_MSS_CONF_ABT_NUM_SLAVES_ADDR A:0x641b0008
y.create.l HWIO_MSS_CONF_ABT_TIMER_LOADVAL_ADDR A:0x641b000c
y.create.l HWIO_MSS_CONF_ABT_TIMER_MODE_ADDR A:0x641b0010
y.create.l HWIO_MSS_CONF_ABT_INTR_STATUS_ADDR A:0x641b0014
y.create.l HWIO_MSS_CONF_ABT_INTR_CLEAR_ADDR A:0x641b0018
y.create.l HWIO_MSS_CONF_ABT_INTR_ENABLE_ADDR A:0x641b001c
y.create.l HWIO_MSS_CONF_ABT_SYND_VALID_ADDR A:0x641b0020
y.create.l HWIO_MSS_CONF_ABT_SYND_CLEAR_ADDR A:0x641b0024
y.create.l HWIO_MSS_CONF_ABT_SYND_ID_ADDR A:0x641b0028
y.create.l HWIO_MSS_CONF_ABT_SYND_ADDR0_ADDR A:0x641b002c
y.create.l HWIO_MSS_CONF_ABT_SYND_ADDR1_ADDR A:0x641b0030
y.create.l HWIO_MSS_CONF_ABT_SYND_HREADY_ADDR A:0x641b0034
y.create.l HWIO_MSS_RBCPR_VERSION_ADDR A:0x641b1000
y.create.l HWIO_MSS_RBCPR_SENSOR_MASK0_ADDR A:0x641b1020
y.create.l HWIO_MSS_RBCPR_SENSOR_MASK1_ADDR A:0x641b1024
y.create.l HWIO_MSS_RBCPR_SENSOR_MASK2_ADDR A:0x641b1028
y.create.l HWIO_MSS_RBCPR_SENSOR_MASK3_ADDR A:0x641b102c
y.create.l HWIO_MSS_RBCPR_SENSOR_BYPASS0_ADDR A:0x641b1030
y.create.l HWIO_MSS_RBCPR_SENSOR_BYPASS1_ADDR A:0x641b1034
y.create.l HWIO_MSS_RBCPR_SENSOR_BYPASS2_ADDR A:0x641b1038
y.create.l HWIO_MSS_RBCPR_SENSOR_BYPASS3_ADDR A:0x641b103c
y.create.l HWIO_MSS_RBIF_PMIC_ADDR_ADDR A:0x641b1040
y.create.l HWIO_MSS_RBCPR_TIMER_INTERVAL_ADDR A:0x641b1044
y.create.l HWIO_MSS_RBIF_LIMIT_ADDR A:0x641b1048
y.create.l HWIO_MSS_RBIF_TIMER_ADJUST_ADDR A:0x641b104c
y.create.l HWIO_MSS_RBCPR_GCNT_TARGET0_ADDR A:0x641b1060
y.create.l HWIO_MSS_RBCPR_GCNT_TARGET1_ADDR A:0x641b1064
y.create.l HWIO_MSS_RBCPR_GCNT_TARGET2_ADDR A:0x641b1068
y.create.l HWIO_MSS_RBCPR_GCNT_TARGET3_ADDR A:0x641b106c
y.create.l HWIO_MSS_RBCPR_GCNT_TARGET4_ADDR A:0x641b1070
y.create.l HWIO_MSS_RBCPR_GCNT_TARGET5_ADDR A:0x641b1074
y.create.l HWIO_MSS_RBCPR_GCNT_TARGET6_ADDR A:0x641b1078
y.create.l HWIO_MSS_RBCPR_GCNT_TARGET7_ADDR A:0x641b107c
y.create.l HWIO_MSS_RBCPR_STEP_QUOT_ADDR A:0x641b1080
y.create.l HWIO_MSS_RBCPR_CTL_ADDR A:0x641b1090
y.create.l HWIO_MSS_RBIF_SW_VLEVEL_ADDR A:0x641b1094
y.create.l HWIO_MSS_RBIF_CONT_ACK_CMD_ADDR A:0x641b1098
y.create.l HWIO_MSS_RBIF_CONT_NACK_CMD_ADDR A:0x641b109c
y.create.l HWIO_MSS_RBCPR_RESULT_0_ADDR A:0x641b10a0
y.create.l HWIO_MSS_RBCPR_RESULT_1_ADDR A:0x641b10a4
y.create.l HWIO_MSS_RBIF_IRQ_EN_0_ADDR A:0x641b1100
y.create.l HWIO_MSS_RBIF_IRQ_EN_1_ADDR A:0x641b1104
y.create.l HWIO_MSS_RBIF_IRQ_EN_2_ADDR A:0x641b1108
y.create.l HWIO_MSS_RBIF_IRQ_CLEAR_ADDR A:0x641b1110
y.create.l HWIO_MSS_RBIF_IRQ_STATUS_ADDR A:0x641b1114
y.create.l HWIO_MSS_RBCPR_QUOT_AVG_ADDR A:0x641b1118
y.create.l HWIO_MSS_RBCPR_DEBUG0_ADDR A:0x641b111c
y.create.l HWIO_MSS_RBCPR_DEBUG1_ADDR A:0x641b1120
y.create.l HWIO_MSS_RBCPR_DEBUG2_ADDR A:0x641b1124
y.create.l HWIO_MSS_RBCPR_BIST_MINMAX_ADDR A:0x641b1128
y.create.l HWIO_MSS_RBCPR_BIST_RESULT_ADDR A:0x641b112c
y.create.l HWIO_MSS_RBCPR_BIST_FAIL_MAP0_ADDR A:0x641b1130
y.create.l HWIO_MSS_RBCPR_BIST_FAIL_MAP1_ADDR A:0x641b1134
y.create.l HWIO_MSS_RBCPR_BIST_FAIL_MAP2_ADDR A:0x641b1138
y.create.l HWIO_MSS_RBCPR_BIST_FAIL_MAP3_ADDR A:0x641b113c
y.create.l HWIO_MSS_RBCPR_LOG_0_ADDR A:0x641b1140
y.create.l HWIO_MSS_RBCPR_LOG_1_ADDR A:0x641b1144
y.create.l HWIO_MSS_RBCPR_LOG_2_ADDR A:0x641b1148
y.create.l HWIO_MSS_RBCPR_LOG_3_ADDR A:0x641b114c
y.create.l HWIO_MSS_RBCPR_LOG_4_ADDR A:0x641b1150
y.create.l HWIO_MSS_RBCPR_LOG_5_ADDR A:0x641b1154
y.create.l HWIO_MSS_RBCPR_LOG_6_ADDR A:0x641b1158
y.create.l HWIO_MSS_RBCPR_LOG_7_ADDR A:0x641b115c
y.create.l HWIO_MSS_RBCPR_HTOL_AGE_ADDR A:0x641b1160
y.create.l HWIO_MSS_MGPI_PMIC_CONFIG0_ADDR A:0x641b2000
y.create.l HWIO_MSS_MGPI_PMIC_CONFIG1_ADDR A:0x641b2008
y.create.l HWIO_MSS_MGPI_PMIC_CONFIG2_ADDR A:0x641b2010
y.create.l HWIO_MSS_MGPI_PMIC_CONFIG3_ADDR A:0x641b2018
y.create.l HWIO_MSS_MGPI_PMIC_CONFIG4_ADDR A:0x641b2020
y.create.l HWIO_MSS_MGPI_PMIC_CONFIG5_ADDR A:0x641b2028
y.create.l HWIO_MSS_MGPI_PMIC_CONFIG6_ADDR A:0x641b2030
y.create.l HWIO_MSS_MGPI_PMIC_CONFIG7_ADDR A:0x641b2038
y.create.l HWIO_MSS_MGPI_PMIC_CONFIG8_ADDR A:0x641b2040
y.create.l HWIO_MSS_MGPI_PMIC_CONFIG9_ADDR A:0x641b2048
y.create.l HWIO_MSS_MGPI_CONF_STATUS0_ADDR A:0x641b2004
y.create.l HWIO_MSS_MGPI_CONF_STATUS1_ADDR A:0x641b200c
y.create.l HWIO_MSS_MGPI_CONF_STATUS2_ADDR A:0x641b2014
y.create.l HWIO_MSS_MGPI_CONF_STATUS3_ADDR A:0x641b201c
y.create.l HWIO_MSS_MGPI_CONF_STATUS4_ADDR A:0x641b2024
y.create.l HWIO_MSS_MGPI_CONF_STATUS5_ADDR A:0x641b202c
y.create.l HWIO_MSS_MGPI_CONF_STATUS6_ADDR A:0x641b2034
y.create.l HWIO_MSS_MGPI_CONF_STATUS7_ADDR A:0x641b203c
y.create.l HWIO_MSS_MGPI_CONF_STATUS8_ADDR A:0x641b2044
y.create.l HWIO_MSS_MGPI_CONF_STATUS9_ADDR A:0x641b204c
y.create.l HWIO_MSS_MGPI_MASTER_CSR_ADDR A:0x641b2100
y.create.l HWIO_MSS_MGPI_HW_VERSION_ADDR A:0x641b2104
y.create.l HWIO_MVC_ENABLE_ADDR A:0x641b3000
y.create.l HWIO_MVC_DELAY_ADDR A:0x641b3004
y.create.l HWIO_MVC_PMIC_PVC_PORT_SVS2_ADDR A:0x641b3008
y.create.l HWIO_MVC_PMIC_PVC_PORT_SVS_ADDR A:0x641b300c
y.create.l HWIO_MVC_PMIC_PVC_PORT_NOMINAL_ADDR A:0x641b3010
y.create.l HWIO_MVC_PMIC_PVC_PORT_TURBO_ADDR A:0x641b3014
y.create.l HWIO_MVC_PMIC_PVC_PORT_STATUS_ADDR A:0x641b3018
y.create.l HWIO_MVC_MEM_SVS_ADDR A:0x641b301c
y.create.l HWIO_MVC_Q6SS_INTERFACE_STATE_ADDR A:0x641b3020
y.create.l HWIO_MVC_PMU_INTERFACE_STATE_ADDR A:0x641b3024
y.create.l HWIO_MVC_STATE_MACHINE_ADDR A:0x641b3028
y.create.l HWIO_MVC_HW_VERSION_ADDR A:0x641b302c
y.create.l HWIO_MSS_STMR_TIME_RD_ADDR A:0x641b4000
y.create.l HWIO_MSS_STMR_EVT_MATCH_0_ADDR A:0x641b4004
y.create.l HWIO_MSS_STMR_EVT_MATCH_1_ADDR A:0x641b4008
y.create.l HWIO_MSS_STMR_EVT_MATCH_2_ADDR A:0x641b400c
y.create.l HWIO_MSS_STMR_EVT_MATCH_3_ADDR A:0x641b4010
y.create.l HWIO_MSS_STMR_EVT_MATCH_4_ADDR A:0x641b4014
y.create.l HWIO_MSS_STMR_EVT_MATCH_5_ADDR A:0x641b4018
y.create.l HWIO_MSS_STMR_EVT_MATCH_6_ADDR A:0x641b401c
y.create.l HWIO_MSS_STMR_EVT_MATCH_7_ADDR A:0x641b4020
y.create.l HWIO_MSS_STMR_EVT_MATCH_8_ADDR A:0x641b4024
y.create.l HWIO_MSS_STMR_EVT_MATCH_9_ADDR A:0x641b4028
y.create.l HWIO_MSS_CRYPTO_VERSION_ADDR A:0x641fa000
y.create.l HWIO_MSS_CRYPTO_DATA_IN0_ADDR A:0x641fa010
y.create.l HWIO_MSS_CRYPTO_DATA_IN1_ADDR A:0x641fa014
y.create.l HWIO_MSS_CRYPTO_DATA_IN2_ADDR A:0x641fa018
y.create.l HWIO_MSS_CRYPTO_DATA_IN3_ADDR A:0x641fa01c
y.create.l HWIO_MSS_CRYPTO_DATA_OUT0_ADDR A:0x641fa020
y.create.l HWIO_MSS_CRYPTO_DATA_OUT1_ADDR A:0x641fa024
y.create.l HWIO_MSS_CRYPTO_DATA_OUT2_ADDR A:0x641fa028
y.create.l HWIO_MSS_CRYPTO_DATA_OUT3_ADDR A:0x641fa02c
y.create.l HWIO_MSS_CRYPTO_STATUS_ADDR A:0x641fa100
y.create.l HWIO_MSS_CRYPTO_STATUS2_ADDR A:0x641fa104
y.create.l HWIO_MSS_CRYPTO_ENGINES_AVAIL_ADDR A:0x641fa108
y.create.l HWIO_MSS_CRYPTO_FIFO_SIZES_ADDR A:0x641fa10c
y.create.l HWIO_MSS_CRYPTO_SEG_SIZE_ADDR A:0x641fa110
y.create.l HWIO_MSS_CRYPTO_GOPROC_ADDR A:0x641fa120
y.create.l HWIO_MSS_CRYPTO_GOPROC_QC_KEY_ADDR A:0x641fb000
y.create.l HWIO_MSS_CRYPTO_GOPROC_OEM_KEY_ADDR A:0x641fc000
y.create.l HWIO_MSS_CRYPTO_ENCR_SEG_CFG_ADDR A:0x641fa200
y.create.l HWIO_MSS_CRYPTO_ENCR_SEG_SIZE_ADDR A:0x641fa204
y.create.l HWIO_MSS_CRYPTO_ENCR_SEG_START_ADDR A:0x641fa208
y.create.l HWIO_MSS_CRYPTO_ENCR_KEY0_ADDR A:0x641fd000
y.create.l HWIO_MSS_CRYPTO_ENCR_KEY1_ADDR A:0x641fd004
y.create.l HWIO_MSS_CRYPTO_ENCR_KEY2_ADDR A:0x641fd008
y.create.l HWIO_MSS_CRYPTO_ENCR_KEY3_ADDR A:0x641fd00c
y.create.l HWIO_MSS_CRYPTO_ENCR_KEY4_ADDR A:0x641fd010
y.create.l HWIO_MSS_CRYPTO_ENCR_KEY5_ADDR A:0x641fd014
y.create.l HWIO_MSS_CRYPTO_ENCR_KEY6_ADDR A:0x641fd018
y.create.l HWIO_MSS_CRYPTO_ENCR_KEY7_ADDR A:0x641fd01c
y.create.l HWIO_MSS_CRYPTO_ENCR_XTS_KEY0_ADDR A:0x641fd020
y.create.l HWIO_MSS_CRYPTO_ENCR_XTS_KEY1_ADDR A:0x641fd024
y.create.l HWIO_MSS_CRYPTO_ENCR_XTS_KEY2_ADDR A:0x641fd028
y.create.l HWIO_MSS_CRYPTO_ENCR_XTS_KEY3_ADDR A:0x641fd02c
y.create.l HWIO_MSS_CRYPTO_ENCR_XTS_KEY4_ADDR A:0x641fd030
y.create.l HWIO_MSS_CRYPTO_ENCR_XTS_KEY5_ADDR A:0x641fd034
y.create.l HWIO_MSS_CRYPTO_ENCR_XTS_KEY6_ADDR A:0x641fd038
y.create.l HWIO_MSS_CRYPTO_ENCR_XTS_KEY7_ADDR A:0x641fd03c
y.create.l HWIO_MSS_CRYPTO_ENCR_CNTR0_IV0_ADDR A:0x641fa20c
y.create.l HWIO_MSS_CRYPTO_ENCR_CNTR1_IV1_ADDR A:0x641fa210
y.create.l HWIO_MSS_CRYPTO_ENCR_CNTR2_IV2_ADDR A:0x641fa214
y.create.l HWIO_MSS_CRYPTO_ENCR_CNTR3_IV3_ADDR A:0x641fa218
y.create.l HWIO_MSS_CRYPTO_ENCR_CNTR_MASK_ADDR A:0x641fa21c
y.create.l HWIO_MSS_CRYPTO_ENCR_CNTR_MASK2_ADDR A:0x641fa234
y.create.l HWIO_MSS_CRYPTO_ENCR_CNTR_MASK1_ADDR A:0x641fa238
y.create.l HWIO_MSS_CRYPTO_ENCR_CNTR_MASK0_ADDR A:0x641fa23c
y.create.l HWIO_MSS_CRYPTO_ENCR_CCM_INIT_CNTR0_ADDR A:0x641fa220
y.create.l HWIO_MSS_CRYPTO_ENCR_CCM_INIT_CNTR1_ADDR A:0x641fa224
y.create.l HWIO_MSS_CRYPTO_ENCR_CCM_INIT_CNTR2_ADDR A:0x641fa228
y.create.l HWIO_MSS_CRYPTO_ENCR_CCM_INIT_CNTR3_ADDR A:0x641fa22c
y.create.l HWIO_MSS_CRYPTO_ENCR_XTS_DU_SIZE_ADDR A:0x641fa230
y.create.l HWIO_MSS_CRYPTO_AUTH_SEG_CFG_ADDR A:0x641fa300
y.create.l HWIO_MSS_CRYPTO_AUTH_SEG_SIZE_ADDR A:0x641fa304
y.create.l HWIO_MSS_CRYPTO_AUTH_SEG_START_ADDR A:0x641fa308
y.create.l HWIO_MSS_CRYPTO_AUTH_KEY0_ADDR A:0x641fd040
y.create.l HWIO_MSS_CRYPTO_AUTH_KEY1_ADDR A:0x641fd044
y.create.l HWIO_MSS_CRYPTO_AUTH_KEY2_ADDR A:0x641fd048
y.create.l HWIO_MSS_CRYPTO_AUTH_KEY3_ADDR A:0x641fd04c
y.create.l HWIO_MSS_CRYPTO_AUTH_KEY4_ADDR A:0x641fd050
y.create.l HWIO_MSS_CRYPTO_AUTH_KEY5_ADDR A:0x641fd054
y.create.l HWIO_MSS_CRYPTO_AUTH_KEY6_ADDR A:0x641fd058
y.create.l HWIO_MSS_CRYPTO_AUTH_KEY7_ADDR A:0x641fd05c
y.create.l HWIO_MSS_CRYPTO_AUTH_KEY8_ADDR A:0x641fd060
y.create.l HWIO_MSS_CRYPTO_AUTH_KEY9_ADDR A:0x641fd064
y.create.l HWIO_MSS_CRYPTO_AUTH_IV0_ADDR A:0x641fa310
y.create.l HWIO_MSS_CRYPTO_AUTH_IV1_ADDR A:0x641fa314
y.create.l HWIO_MSS_CRYPTO_AUTH_IV2_ADDR A:0x641fa318
y.create.l HWIO_MSS_CRYPTO_AUTH_IV3_ADDR A:0x641fa31c
y.create.l HWIO_MSS_CRYPTO_AUTH_IV4_ADDR A:0x641fa320
y.create.l HWIO_MSS_CRYPTO_AUTH_IV5_ADDR A:0x641fa324
y.create.l HWIO_MSS_CRYPTO_AUTH_IV6_ADDR A:0x641fa328
y.create.l HWIO_MSS_CRYPTO_AUTH_IV7_ADDR A:0x641fa32c
y.create.l HWIO_MSS_CRYPTO_AUTH_INFO_NONCE0_ADDR A:0x641fa350
y.create.l HWIO_MSS_CRYPTO_AUTH_INFO_NONCE1_ADDR A:0x641fa354
y.create.l HWIO_MSS_CRYPTO_AUTH_INFO_NONCE2_ADDR A:0x641fa358
y.create.l HWIO_MSS_CRYPTO_AUTH_INFO_NONCE3_ADDR A:0x641fa35c
y.create.l HWIO_MSS_CRYPTO_AUTH_BYTECNT0_ADDR A:0x641fa390
y.create.l HWIO_MSS_CRYPTO_AUTH_BYTECNT1_ADDR A:0x641fa394
y.create.l HWIO_MSS_CRYPTO_AUTH_EXP_MAC0_ADDR A:0x641fa3a0
y.create.l HWIO_MSS_CRYPTO_AUTH_EXP_MAC1_ADDR A:0x641fa3a4
y.create.l HWIO_MSS_CRYPTO_AUTH_EXP_MAC2_ADDR A:0x641fa3a8
y.create.l HWIO_MSS_CRYPTO_AUTH_EXP_MAC3_ADDR A:0x641fa3ac
y.create.l HWIO_MSS_CRYPTO_AUTH_EXP_MAC4_ADDR A:0x641fa3b0
y.create.l HWIO_MSS_CRYPTO_AUTH_EXP_MAC5_ADDR A:0x641fa3b4
y.create.l HWIO_MSS_CRYPTO_AUTH_EXP_MAC6_ADDR A:0x641fa3b8
y.create.l HWIO_MSS_CRYPTO_AUTH_EXP_MAC7_ADDR A:0x641fa3bc
y.create.l HWIO_MSS_CRYPTO_CONFIG_ADDR A:0x641fa400
y.create.l HWIO_MSS_CRYPTO_DEBUG_ENABLE_ADDR A:0x641ff000
y.create.l HWIO_MSS_CRYPTO_DEBUG_ADDR A:0x641ff004
y.create.l HWIO_MSS_CRYPTO_PWR_CTRL_ADDR A:0x641ff008
y.create.l HWIO_MSS_CRYPTO_BAM_CTRL_ADDR A:0x641c4000
y.create.l HWIO_MSS_CRYPTO_BAM_TIMER_ADDR A:0x641c4040
y.create.l HWIO_MSS_CRYPTO_BAM_TIMER_CTRL_ADDR A:0x641c4044
y.create.l HWIO_MSS_CRYPTO_BAM_DESC_CNT_TRSHLD_ADDR A:0x641c4008
y.create.l HWIO_MSS_CRYPTO_BAM_IRQ_STTS_ADDR A:0x641c4014
y.create.l HWIO_MSS_CRYPTO_BAM_IRQ_CLR_ADDR A:0x641c4018
y.create.l HWIO_MSS_CRYPTO_BAM_IRQ_EN_ADDR A:0x641c401c
y.create.l HWIO_MSS_CRYPTO_BAM_CNFG_BITS_ADDR A:0x641c407c
y.create.l HWIO_MSS_CRYPTO_BAM_CNFG_BITS_2_ADDR A:0x641c4084
y.create.l HWIO_MSS_CRYPTO_BAM_REVISION_ADDR A:0x641c5000
y.create.l HWIO_MSS_CRYPTO_BAM_SW_VERSION_ADDR A:0x641c5004
y.create.l HWIO_MSS_CRYPTO_BAM_NUM_PIPES_ADDR A:0x641c5008
y.create.l HWIO_MSS_CRYPTO_BAM_TEST_BUS_SEL_ADDR A:0x641c5010
y.create.l HWIO_MSS_CRYPTO_BAM_TEST_BUS_REG_ADDR A:0x641c5014
y.create.l HWIO_MSS_CRYPTO_BAM_AHB_MASTER_ERR_CTRLS_ADDR A:0x641c5024
y.create.l HWIO_MSS_CRYPTO_BAM_AHB_MASTER_ERR_ADDR_ADDR A:0x641c5028
y.create.l HWIO_MSS_CRYPTO_BAM_AHB_MASTER_ERR_DATA_ADDR A:0x641c502c
y.create.l HWIO_MSS_CRYPTO_BAM_AHB_MASTER_ERR_ADDR_LSB_ADDR A:0x641c5100
y.create.l HWIO_MSS_CRYPTO_BAM_AHB_MASTER_ERR_ADDR_MSB_ADDR A:0x641c5104
y.create.l HWIO_MSS_CRYPTO_BAM_TRUST_REG_ADDR A:0x641c6000
y.create.l HWIO_MSS_CRYPTO_BAM_P_TRUST_REG0_ADDR A:0x641c6020
y.create.l HWIO_MSS_CRYPTO_BAM_P_TRUST_REG1_ADDR A:0x641c6024
y.create.l HWIO_MSS_CRYPTO_BAM_IRQ_SRCS_EE0_ADDR A:0x641c7000
y.create.l HWIO_MSS_CRYPTO_BAM_IRQ_SRCS_EE1_ADDR A:0x641c8000
y.create.l HWIO_MSS_CRYPTO_BAM_IRQ_SRCS_EE2_ADDR A:0x641c9000
y.create.l HWIO_MSS_CRYPTO_BAM_IRQ_SRCS_EE3_ADDR A:0x641ca000
y.create.l HWIO_MSS_CRYPTO_BAM_IRQ_SRCS_EE4_ADDR A:0x641cb000
y.create.l HWIO_MSS_CRYPTO_BAM_IRQ_SRCS_EE5_ADDR A:0x641cc000
y.create.l HWIO_MSS_CRYPTO_BAM_IRQ_SRCS_EE6_ADDR A:0x641cd000
y.create.l HWIO_MSS_CRYPTO_BAM_IRQ_SRCS_EE7_ADDR A:0x641ce000
y.create.l HWIO_MSS_CRYPTO_BAM_IRQ_SRCS_MSK_EE0_ADDR A:0x641c7004
y.create.l HWIO_MSS_CRYPTO_BAM_IRQ_SRCS_MSK_EE1_ADDR A:0x641c8004
y.create.l HWIO_MSS_CRYPTO_BAM_IRQ_SRCS_MSK_EE2_ADDR A:0x641c9004
y.create.l HWIO_MSS_CRYPTO_BAM_IRQ_SRCS_MSK_EE3_ADDR A:0x641ca004
y.create.l HWIO_MSS_CRYPTO_BAM_IRQ_SRCS_MSK_EE4_ADDR A:0x641cb004
y.create.l HWIO_MSS_CRYPTO_BAM_IRQ_SRCS_MSK_EE5_ADDR A:0x641cc004
y.create.l HWIO_MSS_CRYPTO_BAM_IRQ_SRCS_MSK_EE6_ADDR A:0x641cd004
y.create.l HWIO_MSS_CRYPTO_BAM_IRQ_SRCS_MSK_EE7_ADDR A:0x641ce004
y.create.l HWIO_MSS_CRYPTO_BAM_IRQ_SRCS_UNMASKED_EE0_ADDR A:0x641c7008
y.create.l HWIO_MSS_CRYPTO_BAM_IRQ_SRCS_UNMASKED_EE1_ADDR A:0x641c8008
y.create.l HWIO_MSS_CRYPTO_BAM_IRQ_SRCS_UNMASKED_EE2_ADDR A:0x641c9008
y.create.l HWIO_MSS_CRYPTO_BAM_IRQ_SRCS_UNMASKED_EE3_ADDR A:0x641ca008
y.create.l HWIO_MSS_CRYPTO_BAM_IRQ_SRCS_UNMASKED_EE4_ADDR A:0x641cb008
y.create.l HWIO_MSS_CRYPTO_BAM_IRQ_SRCS_UNMASKED_EE5_ADDR A:0x641cc008
y.create.l HWIO_MSS_CRYPTO_BAM_IRQ_SRCS_UNMASKED_EE6_ADDR A:0x641cd008
y.create.l HWIO_MSS_CRYPTO_BAM_IRQ_SRCS_UNMASKED_EE7_ADDR A:0x641ce008
y.create.l HWIO_MSS_CRYPTO_BAM_PIPE_ATTR_EE0_ADDR A:0x641c700c
y.create.l HWIO_MSS_CRYPTO_BAM_PIPE_ATTR_EE1_ADDR A:0x641c800c
y.create.l HWIO_MSS_CRYPTO_BAM_PIPE_ATTR_EE2_ADDR A:0x641c900c
y.create.l HWIO_MSS_CRYPTO_BAM_PIPE_ATTR_EE3_ADDR A:0x641ca00c
y.create.l HWIO_MSS_CRYPTO_BAM_PIPE_ATTR_EE4_ADDR A:0x641cb00c
y.create.l HWIO_MSS_CRYPTO_BAM_PIPE_ATTR_EE5_ADDR A:0x641cc00c
y.create.l HWIO_MSS_CRYPTO_BAM_PIPE_ATTR_EE6_ADDR A:0x641cd00c
y.create.l HWIO_MSS_CRYPTO_BAM_PIPE_ATTR_EE7_ADDR A:0x641ce00c
y.create.l HWIO_MSS_CRYPTO_BAM_IRQ_SRCS_ADDR A:0x641c7010
y.create.l HWIO_MSS_CRYPTO_BAM_IRQ_SRCS_MSK_ADDR A:0x641c7014
y.create.l HWIO_MSS_CRYPTO_BAM_IRQ_SRCS_UNMASKED_ADDR A:0x641c7018
y.create.l HWIO_MSS_CRYPTO_BAM_P_CTRL0_ADDR A:0x641d7000
y.create.l HWIO_MSS_CRYPTO_BAM_P_CTRL1_ADDR A:0x641d8000
y.create.l HWIO_MSS_CRYPTO_BAM_P_RST0_ADDR A:0x641d7004
y.create.l HWIO_MSS_CRYPTO_BAM_P_RST1_ADDR A:0x641d8004
y.create.l HWIO_MSS_CRYPTO_BAM_P_HALT0_ADDR A:0x641d7008
y.create.l HWIO_MSS_CRYPTO_BAM_P_HALT1_ADDR A:0x641d8008
y.create.l HWIO_MSS_CRYPTO_BAM_P_IRQ_STTS0_ADDR A:0x641d7010
y.create.l HWIO_MSS_CRYPTO_BAM_P_IRQ_STTS1_ADDR A:0x641d8010
y.create.l HWIO_MSS_CRYPTO_BAM_P_IRQ_CLR0_ADDR A:0x641d7014
y.create.l HWIO_MSS_CRYPTO_BAM_P_IRQ_CLR1_ADDR A:0x641d8014
y.create.l HWIO_MSS_CRYPTO_BAM_P_IRQ_EN0_ADDR A:0x641d7018
y.create.l HWIO_MSS_CRYPTO_BAM_P_IRQ_EN1_ADDR A:0x641d8018
y.create.l HWIO_MSS_CRYPTO_BAM_P_TIMER0_ADDR A:0x641d701c
y.create.l HWIO_MSS_CRYPTO_BAM_P_TIMER1_ADDR A:0x641d801c
y.create.l HWIO_MSS_CRYPTO_BAM_P_TIMER_CTRL0_ADDR A:0x641d7020
y.create.l HWIO_MSS_CRYPTO_BAM_P_TIMER_CTRL1_ADDR A:0x641d8020
y.create.l HWIO_MSS_CRYPTO_BAM_P_PRDCR_SDBND0_ADDR A:0x641d7024
y.create.l HWIO_MSS_CRYPTO_BAM_P_PRDCR_SDBND1_ADDR A:0x641d8024
y.create.l HWIO_MSS_CRYPTO_BAM_P_CNSMR_SDBND0_ADDR A:0x641d7028
y.create.l HWIO_MSS_CRYPTO_BAM_P_CNSMR_SDBND1_ADDR A:0x641d8028
y.create.l HWIO_MSS_CRYPTO_BAM_P_SW_OFSTS0_ADDR A:0x641d7800
y.create.l HWIO_MSS_CRYPTO_BAM_P_SW_OFSTS1_ADDR A:0x641d8800
y.create.l HWIO_MSS_CRYPTO_BAM_P_AU_PSM_CNTXT_1_0_ADDR A:0x641d7804
y.create.l HWIO_MSS_CRYPTO_BAM_P_AU_PSM_CNTXT_1_1_ADDR A:0x641d8804
y.create.l HWIO_MSS_CRYPTO_BAM_P_PSM_CNTXT_2_0_ADDR A:0x641d7808
y.create.l HWIO_MSS_CRYPTO_BAM_P_PSM_CNTXT_2_1_ADDR A:0x641d8808
y.create.l HWIO_MSS_CRYPTO_BAM_P_PSM_CNTXT_3_0_ADDR A:0x641d780c
y.create.l HWIO_MSS_CRYPTO_BAM_P_PSM_CNTXT_3_1_ADDR A:0x641d880c
y.create.l HWIO_MSS_CRYPTO_BAM_P_PSM_CNTXT_4_0_ADDR A:0x641d7810
y.create.l HWIO_MSS_CRYPTO_BAM_P_PSM_CNTXT_4_1_ADDR A:0x641d8810
y.create.l HWIO_MSS_CRYPTO_BAM_P_PSM_CNTXT_5_0_ADDR A:0x641d7814
y.create.l HWIO_MSS_CRYPTO_BAM_P_PSM_CNTXT_5_1_ADDR A:0x641d8814
y.create.l HWIO_MSS_CRYPTO_BAM_P_EVNT_REG0_ADDR A:0x641d7818
y.create.l HWIO_MSS_CRYPTO_BAM_P_EVNT_REG1_ADDR A:0x641d8818
y.create.l HWIO_MSS_CRYPTO_BAM_P_DESC_FIFO_ADDR0_ADDR A:0x641d781c
y.create.l HWIO_MSS_CRYPTO_BAM_P_DESC_FIFO_ADDR1_ADDR A:0x641d881c
y.create.l HWIO_MSS_CRYPTO_BAM_P_FIFO_SIZES0_ADDR A:0x641d7820
y.create.l HWIO_MSS_CRYPTO_BAM_P_FIFO_SIZES1_ADDR A:0x641d8820
y.create.l HWIO_MSS_CRYPTO_BAM_P_DATA_FIFO_ADDR0_ADDR A:0x641d7824
y.create.l HWIO_MSS_CRYPTO_BAM_P_DATA_FIFO_ADDR1_ADDR A:0x641d8824
y.create.l HWIO_MSS_CRYPTO_BAM_P_EVNT_GEN_TRSHLD0_ADDR A:0x641d7828
y.create.l HWIO_MSS_CRYPTO_BAM_P_EVNT_GEN_TRSHLD1_ADDR A:0x641d8828
y.create.l HWIO_MSS_CRYPTO_BAM_P_EVNT_DEST_ADDR0_ADDR A:0x641d782c
y.create.l HWIO_MSS_CRYPTO_BAM_P_EVNT_DEST_ADDR1_ADDR A:0x641d882c
y.create.l HWIO_MSS_CRYPTO_BAM_P_DF_CNTXT_0_ADDR A:0x641d7830
y.create.l HWIO_MSS_CRYPTO_BAM_P_DF_CNTXT_1_ADDR A:0x641d8830
y.create.l HWIO_MSS_CRYPTO_BAM_P_RETR_CNTXT_0_ADDR A:0x641d7834
y.create.l HWIO_MSS_CRYPTO_BAM_P_RETR_CNTXT_1_ADDR A:0x641d8834
y.create.l HWIO_MSS_CRYPTO_BAM_P_SI_CNTXT_0_ADDR A:0x641d7838
y.create.l HWIO_MSS_CRYPTO_BAM_P_SI_CNTXT_1_ADDR A:0x641d8838
y.create.l HWIO_MSS_CRYPTO_BAM_P_PSM_CNTXT_3_LSB0_ADDR A:0x641d7900
y.create.l HWIO_MSS_CRYPTO_BAM_P_PSM_CNTXT_3_LSB1_ADDR A:0x641d8900
y.create.l HWIO_MSS_CRYPTO_BAM_P_PSM_CNTXT_3_MSB0_ADDR A:0x641d7904
y.create.l HWIO_MSS_CRYPTO_BAM_P_PSM_CNTXT_3_MSB1_ADDR A:0x641d8904
y.create.l HWIO_MSS_CRYPTO_BAM_P_DESC_FIFO_ADDR_LSB0_ADDR A:0x641d7910
y.create.l HWIO_MSS_CRYPTO_BAM_P_DESC_FIFO_ADDR_LSB1_ADDR A:0x641d8910
y.create.l HWIO_MSS_CRYPTO_BAM_P_DESC_FIFO_ADDR_MSB0_ADDR A:0x641d7914
y.create.l HWIO_MSS_CRYPTO_BAM_P_DESC_FIFO_ADDR_MSB1_ADDR A:0x641d8914
y.create.l HWIO_MSS_CRYPTO_BAM_P_DATA_FIFO_ADDR_LSB0_ADDR A:0x641d7920
y.create.l HWIO_MSS_CRYPTO_BAM_P_DATA_FIFO_ADDR_LSB1_ADDR A:0x641d8920
y.create.l HWIO_MSS_CRYPTO_BAM_P_DATA_FIFO_ADDR_MSB0_ADDR A:0x641d7924
y.create.l HWIO_MSS_CRYPTO_BAM_P_DATA_FIFO_ADDR_MSB1_ADDR A:0x641d8924
y.create.l HWIO_MSS_CRYPTO_BAM_P_EVNT_DEST_ADDR_LSB0_ADDR A:0x641d7930
y.create.l HWIO_MSS_CRYPTO_BAM_P_EVNT_DEST_ADDR_LSB1_ADDR A:0x641d8930
y.create.l HWIO_MSS_CRYPTO_BAM_P_EVNT_DEST_ADDR_MSB0_ADDR A:0x641d7934
y.create.l HWIO_MSS_CRYPTO_BAM_P_EVNT_DEST_ADDR_MSB1_ADDR A:0x641d8934
y.create.l HWIO_MSS_PDMEM_MIN_ADDR A:0x641b8000
y.create.l HWIO_MSS_PDMEM_MAX_ADDR A:0x641bdffc
y.create.l HWIO_MSS_RFC_MSTS_ADDR A:0x641bfe00
y.create.l HWIO_MSS_RFC_MCTL_ADDR A:0x641bfe04
y.create.l HWIO_MSS_RFC_IPC_ADDR A:0x641bfe08
y.create.l HWIO_MSS_RFC_PIC0MSK_ADDR A:0x641bfe0c
y.create.l HWIO_MSS_RFC_PIC0STS_ADDR A:0x641bfe10
y.create.l HWIO_MSS_RFC_PIC1MSK_ADDR A:0x641bfe14
y.create.l HWIO_MSS_RFC_PIC1STS_ADDR A:0x641bfe18
y.create.l HWIO_MSS_RFC_PIC2MSK_ADDR A:0x641bfe1c
y.create.l HWIO_MSS_RFC_PIC2STS_ADDR A:0x641bfe20
y.create.l HWIO_MSS_RFC_PIC3MSK_ADDR A:0x641bfe24
y.create.l HWIO_MSS_RFC_PIC3STS_ADDR A:0x641bfe28
y.create.l HWIO_MSS_RFC_UTIME_ADDR A:0x641bfe2c
y.create.l HWIO_MSS_RFC_MON_ADDR A:0x641bfe30
y.create.l HWIO_MSS_RFC_MON0_ADDR A:0x641bfe34
y.create.l HWIO_MSS_RFC_MON1_ADDR A:0x641bfe38
y.create.l HWIO_MSS_RFC_MON2_ADDR A:0x641bfe3c
y.create.l HWIO_MSS_RFC_MON3_ADDR A:0x641bfe40
y.create.l HWIO_MSS_RFC_MON4_ADDR A:0x641bfe44
y.create.l HWIO_MSS_RFC_MON5_ADDR A:0x641bfe48
y.create.l HWIO_MSS_RFC_MON6_ADDR A:0x641bfe4c
y.create.l HWIO_MSS_RFC_MON7_ADDR A:0x641bfe50
y.create.l HWIO_MSS_RFC_DMAC_ADDR A:0x641bfe54
y.create.l HWIO_MSS_RFC_DMAC0SRC_ADDR A:0x641bfe58
y.create.l HWIO_MSS_RFC_DMAC1SRC_ADDR A:0x641bfe68
y.create.l HWIO_MSS_RFC_DMAC2SRC_ADDR A:0x641bfe78
y.create.l HWIO_MSS_RFC_DMAC3SRC_ADDR A:0x641bfe88
y.create.l HWIO_MSS_RFC_DMAC4SRC_ADDR A:0x641bfe98
y.create.l HWIO_MSS_RFC_DMAC5SRC_ADDR A:0x641bfea8
y.create.l HWIO_MSS_RFC_DMAC6SRC_ADDR A:0x641bfeb8
y.create.l HWIO_MSS_RFC_DMAC7SRC_ADDR A:0x641bfec8
y.create.l HWIO_MSS_RFC_DMAC0DST_ADDR A:0x641bfe5c
y.create.l HWIO_MSS_RFC_DMAC1DST_ADDR A:0x641bfe6c
y.create.l HWIO_MSS_RFC_DMAC2DST_ADDR A:0x641bfe7c
y.create.l HWIO_MSS_RFC_DMAC3DST_ADDR A:0x641bfe8c
y.create.l HWIO_MSS_RFC_DMAC4DST_ADDR A:0x641bfe9c
y.create.l HWIO_MSS_RFC_DMAC5DST_ADDR A:0x641bfeac
y.create.l HWIO_MSS_RFC_DMAC6DST_ADDR A:0x641bfebc
y.create.l HWIO_MSS_RFC_DMAC7DST_ADDR A:0x641bfecc
y.create.l HWIO_MSS_RFC_DMAC0LNK_ADDR A:0x641bfe60
y.create.l HWIO_MSS_RFC_DMAC1LNK_ADDR A:0x641bfe70
y.create.l HWIO_MSS_RFC_DMAC2LNK_ADDR A:0x641bfe80
y.create.l HWIO_MSS_RFC_DMAC3LNK_ADDR A:0x641bfe90
y.create.l HWIO_MSS_RFC_DMAC4LNK_ADDR A:0x641bfea0
y.create.l HWIO_MSS_RFC_DMAC5LNK_ADDR A:0x641bfeb0
y.create.l HWIO_MSS_RFC_DMAC6LNK_ADDR A:0x641bfec0
y.create.l HWIO_MSS_RFC_DMAC7LNK_ADDR A:0x641bfed0
y.create.l HWIO_MSS_RFC_DMAC0CTL_ADDR A:0x641bfe64
y.create.l HWIO_MSS_RFC_DMAC1CTL_ADDR A:0x641bfe74
y.create.l HWIO_MSS_RFC_DMAC2CTL_ADDR A:0x641bfe84
y.create.l HWIO_MSS_RFC_DMAC3CTL_ADDR A:0x641bfe94
y.create.l HWIO_MSS_RFC_DMAC4CTL_ADDR A:0x641bfea4
y.create.l HWIO_MSS_RFC_DMAC5CTL_ADDR A:0x641bfeb4
y.create.l HWIO_MSS_RFC_DMAC6CTL_ADDR A:0x641bfec4
y.create.l HWIO_MSS_RFC_DMAC7CTL_ADDR A:0x641bfed4
y.create.l HWIO_MSS_RFC_RFI_ADDR A:0x641bfed8
y.create.l HWIO_MSS_RFC_GRFC_SET_ADDR A:0x641bfedc
y.create.l HWIO_MSS_RFC_GRFC_CLR_ADDR A:0x641bfee0
y.create.l HWIO_MSS_RFC_SSBI0_ADDR A:0x641bfee4
y.create.l HWIO_MSS_RFC_SSBI1_ADDR A:0x641bfeec
y.create.l HWIO_MSS_RFC_SSBI0DAT_ADDR A:0x641bfee8
y.create.l HWIO_MSS_RFC_SSBI1DAT_ADDR A:0x641bfef0
y.create.l HWIO_MSS_RFC_RFFE0_ADDR A:0x641bfef4
y.create.l HWIO_MSS_RFC_RFFE1_ADDR A:0x641bfefc
y.create.l HWIO_MSS_RFC_RFFE2_ADDR A:0x641bff04
y.create.l HWIO_MSS_RFC_RFFE3_ADDR A:0x641bff0c
y.create.l HWIO_MSS_RFC_RFFE4_ADDR A:0x641bff14
y.create.l HWIO_MSS_RFC_RFFE5_ADDR A:0x641bff1c
y.create.l HWIO_MSS_RFC_RFFE6_ADDR A:0x641bff24
y.create.l HWIO_MSS_RFC_RFFE0DAT_ADDR A:0x641bfef8
y.create.l HWIO_MSS_RFC_RFFE1DAT_ADDR A:0x641bff00
y.create.l HWIO_MSS_RFC_RFFE2DAT_ADDR A:0x641bff08
y.create.l HWIO_MSS_RFC_RFFE3DAT_ADDR A:0x641bff10
y.create.l HWIO_MSS_RFC_RFFE4DAT_ADDR A:0x641bff18
y.create.l HWIO_MSS_RFC_RFFE5DAT_ADDR A:0x641bff20
y.create.l HWIO_MSS_RFC_RFFE6DAT_ADDR A:0x641bff28
y.create.l HWIO_MSS_RFC_BP0_ADDR A:0x641bff2c
y.create.l HWIO_MSS_RFC_BP1_ADDR A:0x641bff30
y.create.l HWIO_MSS_RFC_RFI_ERR_ADDR A:0x641bff34
y.create.l HWIO_MSS_QDSP6SS_VERSION_ADDR A:0x64080000
y.create.l HWIO_MSS_QDSP6SS_CONFIG_ID_ADDR A:0x64080004
y.create.l HWIO_MSS_QDSP6SS_RST_EVB_ADDR A:0x64080010
y.create.l HWIO_MSS_QDSP6SS_RESET_ADDR A:0x64080014
y.create.l HWIO_MSS_QDSP6SS_DBG_CFG_ADDR A:0x64080018
y.create.l HWIO_MSS_QDSP6SS_RET_CFG_ADDR A:0x6408001c
y.create.l HWIO_MSS_QDSP6SS_GFMUX_CTL_ADDR A:0x64080020
y.create.l HWIO_MSS_QDSP6SS_GFMUX_STATUS_ADDR A:0x64080024
y.create.l HWIO_MSS_QDSP6SS_CORE_CMD_RCGR_ADDR A:0x64080028
y.create.l HWIO_MSS_QDSP6SS_CORE_CFG_RCGR_ADDR A:0x6408002c
y.create.l HWIO_MSS_QDSP6SS_PWR_CTL_ADDR A:0x64080030
y.create.l HWIO_MSS_QDSP6SS_CGC_OVERRIDE_ADDR A:0x64080034
y.create.l HWIO_MSS_QDSP6SS_XO_CBCR_ADDR A:0x64080038
y.create.l HWIO_MSS_QDSP6SS_SLEEP_CBCR_ADDR A:0x6408003c
y.create.l HWIO_MSS_QDSP6SS_NMI_ADDR A:0x64080040
y.create.l HWIO_MSS_QDSP6SS_NMI_STATUS_ADDR A:0x64080044
y.create.l HWIO_MSS_QDSP6SS_CLOCK_SPDM_MON_ADDR A:0x64080048
y.create.l HWIO_MSS_QDSP6SS_STATERET_CTL_ADDR A:0x6408004c
y.create.l HWIO_MSS_QDSP6SS_LDO_CFG0_ADDR A:0x64080050
y.create.l HWIO_MSS_QDSP6SS_LDO_CFG1_ADDR A:0x64080054
y.create.l HWIO_MSS_QDSP6SS_LDO_CFG2_ADDR A:0x64080058
y.create.l HWIO_MSS_QDSP6SS_LDO_VREF_SET_ADDR A:0x6408005c
y.create.l HWIO_MSS_QDSP6SS_LDO_VREF_TEST_CFG_ADDR A:0x64080060
y.create.l HWIO_MSS_QDSP6SS_LDO_VREF_CMD_ADDR A:0x64080064
y.create.l HWIO_MSS_QDSP6SS_QMC_SVS_CTL_ADDR A:0x64080068
y.create.l HWIO_MSS_QDSP6SS_BHS_STATUS_ADDR A:0x6408006c
y.create.l HWIO_MSS_QDSP6SS_LDO_EFUSE_STATUS_ADDR A:0x64080070
y.create.l HWIO_MSS_QDSP6SS_BHS_CTL_ADDR A:0x64080074
y.create.l HWIO_MSS_QDSP6SS_SPM_SW_TRIG_ADDR A:0x64080080
y.create.l HWIO_MSS_QDSP6SS_SPM_TRIG_STATUS_ADDR A:0x64080084
y.create.l HWIO_MSS_QDSP6SS_INTF_HALTREQ_ADDR A:0x64080088
y.create.l HWIO_MSS_QDSP6SS_INTF_HALTACK_ADDR A:0x6408008c
y.create.l HWIO_MSS_QDSP6SS_INTFCLAMP_SET_ADDR A:0x64080090
y.create.l HWIO_MSS_QDSP6SS_INTFCLAMP_CLEAR_ADDR A:0x64080094
y.create.l HWIO_MSS_QDSP6SS_INTFCLAMP_STATUS_ADDR A:0x64080098
y.create.l HWIO_MSS_QDSP6SS_INTF_FIFO_RESET_ADDR A:0x640800a0
y.create.l HWIO_MSS_QDSP6SS_CP_PWR_CTL_ADDR A:0x640800f0
y.create.l HWIO_MSS_QDSP6SS_STRAP_TCM_ADDR A:0x64080100
y.create.l HWIO_MSS_QDSP6SS_STRAP_AHBUPPER_ADDR A:0x64080104
y.create.l HWIO_MSS_QDSP6SS_STRAP_AHBLOWER_ADDR A:0x64080108
y.create.l HWIO_MSS_QDSP6SS_STRAP_ACC_ADDR A:0x64080110
y.create.l HWIO_MSS_QDSP6SS_STRAP_QMC_ACC_ADDR A:0x64080114
y.create.l HWIO_MSS_QDSP6SS_DCC_CTRL_ADDR A:0x64080118
y.create.l HWIO_MSS_QDSP6SS_STRAP_AXIM2UPPER_ADDR A:0x6408011c
y.create.l HWIO_MSS_QDSP6SS_STRAP_AXIM2LOWER_ADDR A:0x64080120
y.create.l HWIO_MSS_QDSP6SS_PLL_MODE_ADDR A:0x64080200
y.create.l HWIO_MSS_QDSP6SS_PLL_L_VAL_ADDR A:0x64080204
y.create.l HWIO_MSS_QDSP6SS_PLL_ALPHA_VAL_ADDR A:0x64080208
y.create.l HWIO_MSS_QDSP6SS_PLL_ALPHA_VAL_U_ADDR A:0x6408020c
y.create.l HWIO_MSS_QDSP6SS_PLL_USER_CTL_ADDR A:0x64080210
y.create.l HWIO_MSS_QDSP6SS_PLL_USER_CTL_U_ADDR A:0x64080214
y.create.l HWIO_MSS_QDSP6SS_PLL_CONFIG_CTL_ADDR A:0x64080218
y.create.l HWIO_MSS_QDSP6SS_PLL_TEST_CTL_ADDR A:0x6408021c
y.create.l HWIO_MSS_QDSP6SS_PLL_TEST_CTL_U_ADDR A:0x64080220
y.create.l HWIO_MSS_QDSP6SS_PLL_STATUS_ADDR A:0x64080224
y.create.l HWIO_MSS_QDSP6SS_PLL_FREQ_CTL_ADDR A:0x64080228
y.create.l HWIO_MSS_QDSP6SS_PLL_RCG_UPDATE_CFG_ADDR A:0x64080240
y.create.l HWIO_MSS_QDSP6SS_PLL_RCG_UPDATE_DLYCTL_ADDR A:0x64080244
y.create.l HWIO_MSS_QDSP6SS_PLL_RCG_UPDATE_CMD_ADDR A:0x64080248
y.create.l HWIO_MSS_QDSP6SS_PLL_RCG_UPDATE_STATUS_ADDR A:0x6408023c
y.create.l HWIO_MSS_QDSP6SS_EXT_WAKEUP_ADDR A:0x64081000
y.create.l HWIO_MSS_QDSP6SS_EXT_PD_ADDR A:0x64081004
y.create.l HWIO_MSS_QDSP6SS_TEST_BUS_CTL_ADDR A:0x64082000
y.create.l HWIO_MSS_QDSP6SS_TEST_BUS_VALUE_ADDR A:0x64082004
y.create.l HWIO_MSS_QDSP6SS_TEST_BUS_WDATA_ADDR A:0x64082008
y.create.l HWIO_MSS_QDSP6SS_PWRDBG_CTL_ADDR A:0x6408200c
y.create.l HWIO_MSS_QDSP6SS_TEST_CLK_CTL_ADDR A:0x64082010
y.create.l HWIO_MSS_QDSP6SS_PWRDBG_STATUS_ADDR A:0x64082014
y.create.l HWIO_MSS_QDSP6SS_ZMEAS_CONFIG_ADDR A:0x64082018
y.create.l HWIO_MSS_QDSP6SS_LDO_ATEST_ADDR A:0x6408201c
y.create.l HWIO_MSS_QDSP6SS_LDO_DAC_STATUS_LOW_ADDR A:0x64082020
y.create.l HWIO_MSS_QDSP6SS_LDO_DAC_STATUS_HIGH_ADDR A:0x64082024
y.create.l HWIO_MSS_QDSP6SS_CORE_STATUS_ADDR A:0x64082028
y.create.l HWIO_MSS_QDSP6SS_INSTANCE_ID_ADDR A:0x64100000
y.create.l HWIO_MSS_QDSP6SS_IDLT_MATCH_VAL_ADDR A:0x64101000
y.create.l HWIO_MSS_QDSP6SS_IDLT_COUNT_VAL_ADDR A:0x64101004
y.create.l HWIO_MSS_QDSP6SS_IDLT_ENABLE_ADDR A:0x64101008
y.create.l HWIO_MSS_QDSP6SS_IDLT_SYNC_STATUS_ADDR A:0x6410100c
y.create.l HWIO_MSS_QDSP6SS_WDOG_RESET_ADDR A:0x64102000
y.create.l HWIO_MSS_QDSP6SS_WDOG_CTL_ADDR A:0x64102004
y.create.l HWIO_MSS_QDSP6SS_WDOG_STATUS_ADDR A:0x64102008
y.create.l HWIO_MSS_QDSP6SS_WDOG_BARK_TIME_ADDR A:0x6410200c
y.create.l HWIO_MSS_QDSP6SS_WDOG_BITE_TIME_ADDR A:0x64102010
y.create.l HWIO_MSS_QDSP6SS_WDOG_NMI_TIME_ADDR A:0x64102014
y.create.l HWIO_MSS_QDSP6SS_WDOG_TEST_LOAD_ADDR A:0x64102018
y.create.l HWIO_MSS_QDSP6SS_WDOG_TEST_ADDR A:0x6410201c
y.create.l HWIO_MSS_QDSP6SS_IPC_ADDR A:0x64105000
y.create.l HWIO_MSS_QDSP6SS_L1_IRQ_BACKUP_EN_ADDR A:0x64105010
y.create.l HWIO_MSS_QDSP6SS_BLOCK_INTR_ADDR A:0x64107008
y.create.l HWIO_MSS_QDSP6SS_PD_HS_START_ADDR A:0x6410700c
y.create.l HWIO_MSS_QDSP6SS_PD_HS_DONE_ADDR A:0x64107010
y.create.l HWIO_MSS_QDSP6SS_PU_HS_START_ADDR A:0x64107014
y.create.l HWIO_MSS_QDSP6SS_SLPC_CFG_ADDR A:0x6410701c
y.create.l HWIO_MSS_QDSP6SS_SLPC_STATUS_ADDR A:0x64107020
y.create.l HWIO_MSS_QDSP6SS_MVC_PWR_REQ_ADDR A:0x64107030
y.create.l HWIO_MSS_QDSP6SS_SPM_EVENT_CTL_ADDR A:0x64107050
y.create.l HWIO_MSS_QDSP6SS_SPM_TRIG_CFG0_ADDR A:0x64107080
y.create.l HWIO_MSS_QDSP6SS_SPM_TRIG_CFG1_ADDR A:0x64107084
y.create.l HWIO_MSS_QDSP6SS_SPMCTL_EN_ARES_ADDR A:0x64107100
y.create.l HWIO_MSS_QDSP6SS_SPMCTL_EN_CLAMP_ADDR A:0x64107104
y.create.l HWIO_MSS_QDSP6SS_SPMCTL_EN_CLK_ADDR A:0x64107108
y.create.l HWIO_MSS_QDSP6SS_SPMCTL_EN_MEM_ADDR A:0x6410710c
y.create.l HWIO_MSS_QDSP6SS_SPMCTL_EN_MEM_CP_ADDR A:0x64107110
y.create.l HWIO_MSS_QDSP6SS_SPMCTL_EN_BHS_ADDR A:0x64107114
y.create.l HWIO_MSS_QDSP6SS_SPMCTL_EN_LDO_ADDR A:0x64107118
y.create.l HWIO_MSS_QDSP6SS_SPMCTL_EN_EXT_ADDR A:0x6410711c
y.create.l HWIO_MSS_QDSP6SS_SPMCTL_EN_PLL_ADDR A:0x64107120
y.create.l HWIO_MSS_QDSP6SS_SPMCTL_EN_STATERET_ADDR A:0x64107124
y.create.l HWIO_MSS_QDSP6SS_SPMCTL_EN_ISOINTF_CTL_ADDR A:0x64107128
y.create.l HWIO_MSS_QDSP6SS_SPMCTL_EN_ISOINTF_CLAMP_ADDR A:0x6410712c
y.create.l HWIO_MSS_QDSP6SS_SPMCTL_EN_ISOINTF_CLK_ADDR A:0x64107130
y.create.l HWIO_MSS_QDSP6SS_SPMCTL_EN_ARES_SET_ADDR A:0x64107180
y.create.l HWIO_MSS_QDSP6SS_SPMCTL_EN_CLAMP_SET_ADDR A:0x64107184
y.create.l HWIO_MSS_QDSP6SS_SPMCTL_EN_CLK_SET_ADDR A:0x64107188
y.create.l HWIO_MSS_QDSP6SS_SPMCTL_EN_MEM_SET_ADDR A:0x6410718c
y.create.l HWIO_MSS_QDSP6SS_SPMCTL_EN_MEM_CP_SET_ADDR A:0x64107190
y.create.l HWIO_MSS_QDSP6SS_SPMCTL_EN_BHS_SET_ADDR A:0x64107194
y.create.l HWIO_MSS_QDSP6SS_SPMCTL_EN_LDO_SET_ADDR A:0x64107198
y.create.l HWIO_MSS_QDSP6SS_SPMCTL_EN_EXT_SET_ADDR A:0x6410719c
y.create.l HWIO_MSS_QDSP6SS_SPMCTL_EN_PLL_SET_ADDR A:0x641071a0
y.create.l HWIO_MSS_QDSP6SS_SPMCTL_EN_STATERET_SET_ADDR A:0x641071a4
y.create.l HWIO_MSS_QDSP6SS_SPMCTL_EN_ISOINTF_CTL_SET_ADDR A:0x641071a8
y.create.l HWIO_MSS_QDSP6SS_SPMCTL_EN_ISOINTF_CLAMP_SET_ADDR A:0x641071ac
y.create.l HWIO_MSS_QDSP6SS_SPMCTL_EN_ISOINTF_CLK_SET_ADDR A:0x641071b0
y.create.l HWIO_MSS_QDSP6SS_SPMCTL_EN_ARES_CLEAR_ADDR A:0x64107200
y.create.l HWIO_MSS_QDSP6SS_SPMCTL_EN_CLAMP_CLEAR_ADDR A:0x64107204
y.create.l HWIO_MSS_QDSP6SS_SPMCTL_EN_CLK_CLEAR_ADDR A:0x64107208
y.create.l HWIO_MSS_QDSP6SS_SPMCTL_EN_MEM_CLEAR_ADDR A:0x6410720c
y.create.l HWIO_MSS_QDSP6SS_SPMCTL_EN_MEM_CP_CLEAR_ADDR A:0x64107210
y.create.l HWIO_MSS_QDSP6SS_SPMCTL_EN_BHS_CLEAR_ADDR A:0x64107214
y.create.l HWIO_MSS_QDSP6SS_SPMCTL_EN_LDO_CLEAR_ADDR A:0x64107218
y.create.l HWIO_MSS_QDSP6SS_SPMCTL_EN_EXT_CLEAR_ADDR A:0x6410721c
y.create.l HWIO_MSS_QDSP6SS_SPMCTL_EN_PLL_CLEAR_ADDR A:0x64107220
y.create.l HWIO_MSS_QDSP6SS_SPMCTL_EN_STATERET_CLEAR_ADDR A:0x64107224
y.create.l HWIO_MSS_QDSP6SS_SPMCTL_EN_ISOINTF_CTL_CLEAR_ADDR A:0x64107228
y.create.l HWIO_MSS_QDSP6SS_SPMCTL_EN_ISOINTF_CLAMP_CLEAR_ADDR A:0x6410722c
y.create.l HWIO_MSS_QDSP6SS_SPMCTL_EN_ISOINTF_CLK_CLEAR_ADDR A:0x64107230
y.create.l HWIO_MSS_QDSP6SS_L2VIC_VID_ADDR A:0x64110000
y.create.l HWIO_MSS_QDSP6SS_L2VIC_INT_ENABLE0_ADDR A:0x64110100
y.create.l HWIO_MSS_QDSP6SS_L2VIC_INT_ENABLE1_ADDR A:0x64110104
y.create.l HWIO_MSS_QDSP6SS_L2VIC_INT_ENABLE2_ADDR A:0x64110108
y.create.l HWIO_MSS_QDSP6SS_L2VIC_INT_ENABLE3_ADDR A:0x6411010c
y.create.l HWIO_MSS_QDSP6SS_L2VIC_INT_ENABLE4_ADDR A:0x64110110
y.create.l HWIO_MSS_QDSP6SS_L2VIC_INT_ENABLE5_ADDR A:0x64110114
y.create.l HWIO_MSS_QDSP6SS_L2VIC_INT_ENABLE6_ADDR A:0x64110118
y.create.l HWIO_MSS_QDSP6SS_L2VIC_INT_ENABLE7_ADDR A:0x6411011c
y.create.l HWIO_MSS_QDSP6SS_L2VIC_INT_ENABLE8_ADDR A:0x64110120
y.create.l HWIO_MSS_QDSP6SS_L2VIC_INT_ENABLE9_ADDR A:0x64110124
y.create.l HWIO_MSS_QDSP6SS_L2VIC_INT_ENABLE_CLEAR0_ADDR A:0x64110180
y.create.l HWIO_MSS_QDSP6SS_L2VIC_INT_ENABLE_CLEAR1_ADDR A:0x64110184
y.create.l HWIO_MSS_QDSP6SS_L2VIC_INT_ENABLE_CLEAR2_ADDR A:0x64110188
y.create.l HWIO_MSS_QDSP6SS_L2VIC_INT_ENABLE_CLEAR3_ADDR A:0x6411018c
y.create.l HWIO_MSS_QDSP6SS_L2VIC_INT_ENABLE_CLEAR4_ADDR A:0x64110190
y.create.l HWIO_MSS_QDSP6SS_L2VIC_INT_ENABLE_CLEAR5_ADDR A:0x64110194
y.create.l HWIO_MSS_QDSP6SS_L2VIC_INT_ENABLE_CLEAR6_ADDR A:0x64110198
y.create.l HWIO_MSS_QDSP6SS_L2VIC_INT_ENABLE_CLEAR7_ADDR A:0x6411019c
y.create.l HWIO_MSS_QDSP6SS_L2VIC_INT_ENABLE_CLEAR8_ADDR A:0x641101a0
y.create.l HWIO_MSS_QDSP6SS_L2VIC_INT_ENABLE_CLEAR9_ADDR A:0x641101a4
y.create.l HWIO_MSS_QDSP6SS_L2VIC_INT_ENABLE_SET0_ADDR A:0x64110200
y.create.l HWIO_MSS_QDSP6SS_L2VIC_INT_ENABLE_SET1_ADDR A:0x64110204
y.create.l HWIO_MSS_QDSP6SS_L2VIC_INT_ENABLE_SET2_ADDR A:0x64110208
y.create.l HWIO_MSS_QDSP6SS_L2VIC_INT_ENABLE_SET3_ADDR A:0x6411020c
y.create.l HWIO_MSS_QDSP6SS_L2VIC_INT_ENABLE_SET4_ADDR A:0x64110210
y.create.l HWIO_MSS_QDSP6SS_L2VIC_INT_ENABLE_SET5_ADDR A:0x64110214
y.create.l HWIO_MSS_QDSP6SS_L2VIC_INT_ENABLE_SET6_ADDR A:0x64110218
y.create.l HWIO_MSS_QDSP6SS_L2VIC_INT_ENABLE_SET7_ADDR A:0x6411021c
y.create.l HWIO_MSS_QDSP6SS_L2VIC_INT_ENABLE_SET8_ADDR A:0x64110220
y.create.l HWIO_MSS_QDSP6SS_L2VIC_INT_ENABLE_SET9_ADDR A:0x64110224
y.create.l HWIO_MSS_QDSP6SS_L2VIC_INT_TYPE0_ADDR A:0x64110280
y.create.l HWIO_MSS_QDSP6SS_L2VIC_INT_TYPE1_ADDR A:0x64110284
y.create.l HWIO_MSS_QDSP6SS_L2VIC_INT_TYPE2_ADDR A:0x64110288
y.create.l HWIO_MSS_QDSP6SS_L2VIC_INT_TYPE3_ADDR A:0x6411028c
y.create.l HWIO_MSS_QDSP6SS_L2VIC_INT_TYPE4_ADDR A:0x64110290
y.create.l HWIO_MSS_QDSP6SS_L2VIC_INT_TYPE5_ADDR A:0x64110294
y.create.l HWIO_MSS_QDSP6SS_L2VIC_INT_TYPE6_ADDR A:0x64110298
y.create.l HWIO_MSS_QDSP6SS_L2VIC_INT_TYPE7_ADDR A:0x6411029c
y.create.l HWIO_MSS_QDSP6SS_L2VIC_INT_TYPE8_ADDR A:0x641102a0
y.create.l HWIO_MSS_QDSP6SS_L2VIC_INT_TYPE9_ADDR A:0x641102a4
y.create.l HWIO_MSS_QDSP6SS_L2VIC_INT_STATUS0_ADDR A:0x64110380
y.create.l HWIO_MSS_QDSP6SS_L2VIC_INT_STATUS1_ADDR A:0x64110384
y.create.l HWIO_MSS_QDSP6SS_L2VIC_INT_STATUS2_ADDR A:0x64110388
y.create.l HWIO_MSS_QDSP6SS_L2VIC_INT_STATUS3_ADDR A:0x6411038c
y.create.l HWIO_MSS_QDSP6SS_L2VIC_INT_STATUS4_ADDR A:0x64110390
y.create.l HWIO_MSS_QDSP6SS_L2VIC_INT_STATUS5_ADDR A:0x64110394
y.create.l HWIO_MSS_QDSP6SS_L2VIC_INT_STATUS6_ADDR A:0x64110398
y.create.l HWIO_MSS_QDSP6SS_L2VIC_INT_STATUS7_ADDR A:0x6411039c
y.create.l HWIO_MSS_QDSP6SS_L2VIC_INT_STATUS8_ADDR A:0x641103a0
y.create.l HWIO_MSS_QDSP6SS_L2VIC_INT_STATUS9_ADDR A:0x641103a4
y.create.l HWIO_MSS_QDSP6SS_L2VIC_INT_CLEAR0_ADDR A:0x64110400
y.create.l HWIO_MSS_QDSP6SS_L2VIC_INT_CLEAR1_ADDR A:0x64110404
y.create.l HWIO_MSS_QDSP6SS_L2VIC_INT_CLEAR2_ADDR A:0x64110408
y.create.l HWIO_MSS_QDSP6SS_L2VIC_INT_CLEAR3_ADDR A:0x6411040c
y.create.l HWIO_MSS_QDSP6SS_L2VIC_INT_CLEAR4_ADDR A:0x64110410
y.create.l HWIO_MSS_QDSP6SS_L2VIC_INT_CLEAR5_ADDR A:0x64110414
y.create.l HWIO_MSS_QDSP6SS_L2VIC_INT_CLEAR6_ADDR A:0x64110418
y.create.l HWIO_MSS_QDSP6SS_L2VIC_INT_CLEAR7_ADDR A:0x6411041c
y.create.l HWIO_MSS_QDSP6SS_L2VIC_INT_CLEAR8_ADDR A:0x64110420
y.create.l HWIO_MSS_QDSP6SS_L2VIC_INT_CLEAR9_ADDR A:0x64110424
y.create.l HWIO_MSS_QDSP6SS_L2VIC_SOFT_INT0_ADDR A:0x64110480
y.create.l HWIO_MSS_QDSP6SS_L2VIC_SOFT_INT1_ADDR A:0x64110484
y.create.l HWIO_MSS_QDSP6SS_L2VIC_SOFT_INT2_ADDR A:0x64110488
y.create.l HWIO_MSS_QDSP6SS_L2VIC_SOFT_INT3_ADDR A:0x6411048c
y.create.l HWIO_MSS_QDSP6SS_L2VIC_SOFT_INT4_ADDR A:0x64110490
y.create.l HWIO_MSS_QDSP6SS_L2VIC_SOFT_INT5_ADDR A:0x64110494
y.create.l HWIO_MSS_QDSP6SS_L2VIC_SOFT_INT6_ADDR A:0x64110498
y.create.l HWIO_MSS_QDSP6SS_L2VIC_SOFT_INT7_ADDR A:0x6411049c
y.create.l HWIO_MSS_QDSP6SS_L2VIC_SOFT_INT8_ADDR A:0x641104a0
y.create.l HWIO_MSS_QDSP6SS_L2VIC_SOFT_INT9_ADDR A:0x641104a4
y.create.l HWIO_MSS_QDSP6SS_L2VIC_INT_PENDING0_ADDR A:0x64110500
y.create.l HWIO_MSS_QDSP6SS_L2VIC_INT_PENDING1_ADDR A:0x64110504
y.create.l HWIO_MSS_QDSP6SS_L2VIC_INT_PENDING2_ADDR A:0x64110508
y.create.l HWIO_MSS_QDSP6SS_L2VIC_INT_PENDING3_ADDR A:0x6411050c
y.create.l HWIO_MSS_QDSP6SS_L2VIC_INT_PENDING4_ADDR A:0x64110510
y.create.l HWIO_MSS_QDSP6SS_L2VIC_INT_PENDING5_ADDR A:0x64110514
y.create.l HWIO_MSS_QDSP6SS_L2VIC_INT_PENDING6_ADDR A:0x64110518
y.create.l HWIO_MSS_QDSP6SS_L2VIC_INT_PENDING7_ADDR A:0x6411051c
y.create.l HWIO_MSS_QDSP6SS_L2VIC_INT_PENDING8_ADDR A:0x64110520
y.create.l HWIO_MSS_QDSP6SS_L2VIC_INT_PENDING9_ADDR A:0x64110524
y.create.l HWIO_MSS_QDSP6SS_QTMR_AC_CNTFRQ_ADDR A:0x64120000
y.create.l HWIO_MSS_QDSP6SS_QTMR_AC_CNTSR_ADDR A:0x64120004
y.create.l HWIO_MSS_QDSP6SS_QTMR_AC_CNTTID_ADDR A:0x64120008
y.create.l HWIO_MSS_QDSP6SS_QTMR_AC_CNTACR_0_ADDR A:0x64120040
y.create.l HWIO_MSS_QDSP6SS_QTMR_AC_CNTACR_1_ADDR A:0x64120044
y.create.l HWIO_MSS_QDSP6SS_QTMR_AC_CNTACR_2_ADDR A:0x64120048
y.create.l HWIO_MSS_QDSP6SS_QTMR_AC_CNTVOFF_LO_0_ADDR A:0x64120080
y.create.l HWIO_MSS_QDSP6SS_QTMR_AC_CNTVOFF_LO_1_ADDR A:0x64120088
y.create.l HWIO_MSS_QDSP6SS_QTMR_AC_CNTVOFF_LO_2_ADDR A:0x64120090
y.create.l HWIO_MSS_QDSP6SS_QTMR_AC_CNTVOFF_HI_0_ADDR A:0x64120084
y.create.l HWIO_MSS_QDSP6SS_QTMR_AC_CNTVOFF_HI_1_ADDR A:0x6412008c
y.create.l HWIO_MSS_QDSP6SS_QTMR_AC_CNTVOFF_HI_2_ADDR A:0x64120094
y.create.l HWIO_MSS_QDSP6SS_QTMR_AC_CFG_ADDR A:0x64120fc0
y.create.l HWIO_MSS_QDSP6SS_QTMR_AC_VERSION_ADDR A:0x64120fd0
y.create.l HWIO_MSS_QDSP6SS_QTMR_V1_CNTPCT_LO_0_ADDR A:0x64121000
y.create.l HWIO_MSS_QDSP6SS_QTMR_V1_CNTPCT_HI_0_ADDR A:0x64121004
y.create.l HWIO_MSS_QDSP6SS_QTMR_V1_CNTVCT_LO_0_ADDR A:0x64121008
y.create.l HWIO_MSS_QDSP6SS_QTMR_V1_CNTVCT_HI_0_ADDR A:0x6412100c
y.create.l HWIO_MSS_QDSP6SS_QTMR_V1_CNTFRQ_0_ADDR A:0x64121010
y.create.l HWIO_MSS_QDSP6SS_QTMR_V1_CNTPL0ACR_0_ADDR A:0x64121014
y.create.l HWIO_MSS_QDSP6SS_QTMR_V1_CNTVOFF_LO_0_ADDR A:0x64121018
y.create.l HWIO_MSS_QDSP6SS_QTMR_V1_CNTVOFF_HI_0_ADDR A:0x6412101c
y.create.l HWIO_MSS_QDSP6SS_QTMR_V1_CNTP_CVAL_LO_0_ADDR A:0x64121020
y.create.l HWIO_MSS_QDSP6SS_QTMR_V1_CNTP_CVAL_HI_0_ADDR A:0x64121024
y.create.l HWIO_MSS_QDSP6SS_QTMR_V1_CNTP_TVAL_0_ADDR A:0x64121028
y.create.l HWIO_MSS_QDSP6SS_QTMR_V1_CNTP_CTL_0_ADDR A:0x6412102c
y.create.l HWIO_MSS_QDSP6SS_QTMR_V1_CNTV_CVAL_LO_0_ADDR A:0x64121030
y.create.l HWIO_MSS_QDSP6SS_QTMR_V1_CNTV_CVAL_HI_0_ADDR A:0x64121034
y.create.l HWIO_MSS_QDSP6SS_QTMR_V1_CNTV_TVAL_0_ADDR A:0x64121038
y.create.l HWIO_MSS_QDSP6SS_QTMR_V1_CNTV_CTL_0_ADDR A:0x6412103c
y.create.l HWIO_MSS_QDSP6SS_QTMR_V1_VERSION_0_ADDR A:0x64121fd0
y.create.l HWIO_MSS_QDSP6SS_QTMR_V1_CNTPCT_LO_1_ADDR A:0x64122000
y.create.l HWIO_MSS_QDSP6SS_QTMR_V1_CNTPCT_HI_1_ADDR A:0x64122004
y.create.l HWIO_MSS_QDSP6SS_QTMR_V1_CNTVCT_LO_1_ADDR A:0x64122008
y.create.l HWIO_MSS_QDSP6SS_QTMR_V1_CNTVCT_HI_1_ADDR A:0x6412200c
y.create.l HWIO_MSS_QDSP6SS_QTMR_V1_CNTFRQ_1_ADDR A:0x64122010
y.create.l HWIO_MSS_QDSP6SS_QTMR_V1_CNTPL0ACR_1_ADDR A:0x64122014
y.create.l HWIO_MSS_QDSP6SS_QTMR_V1_CNTVOFF_LO_1_ADDR A:0x64122018
y.create.l HWIO_MSS_QDSP6SS_QTMR_V1_CNTVOFF_HI_1_ADDR A:0x6412201c
y.create.l HWIO_MSS_QDSP6SS_QTMR_V1_CNTP_CVAL_LO_1_ADDR A:0x64122020
y.create.l HWIO_MSS_QDSP6SS_QTMR_V1_CNTP_CVAL_HI_1_ADDR A:0x64122024
y.create.l HWIO_MSS_QDSP6SS_QTMR_V1_CNTP_TVAL_1_ADDR A:0x64122028
y.create.l HWIO_MSS_QDSP6SS_QTMR_V1_CNTP_CTL_1_ADDR A:0x6412202c
y.create.l HWIO_MSS_QDSP6SS_QTMR_V1_CNTV_CVAL_LO_1_ADDR A:0x64122030
y.create.l HWIO_MSS_QDSP6SS_QTMR_V1_CNTV_CVAL_HI_1_ADDR A:0x64122034
y.create.l HWIO_MSS_QDSP6SS_QTMR_V1_CNTV_TVAL_1_ADDR A:0x64122038
y.create.l HWIO_MSS_QDSP6SS_QTMR_V1_CNTV_CTL_1_ADDR A:0x6412203c
y.create.l HWIO_MSS_QDSP6SS_QTMR_V1_VERSION_1_ADDR A:0x64122fd0
y.create.l HWIO_MSS_QDSP6SS_QTMR_V1_CNTPCT_LO_2_ADDR A:0x64123000
y.create.l HWIO_MSS_QDSP6SS_QTMR_V1_CNTPCT_HI_2_ADDR A:0x64123004
y.create.l HWIO_MSS_QDSP6SS_QTMR_V1_CNTVCT_LO_2_ADDR A:0x64123008
y.create.l HWIO_MSS_QDSP6SS_QTMR_V1_CNTVCT_HI_2_ADDR A:0x6412300c
y.create.l HWIO_MSS_QDSP6SS_QTMR_V1_CNTFRQ_2_ADDR A:0x64123010
y.create.l HWIO_MSS_QDSP6SS_QTMR_V1_CNTPL0ACR_2_ADDR A:0x64123014
y.create.l HWIO_MSS_QDSP6SS_QTMR_V1_CNTVOFF_LO_2_ADDR A:0x64123018
y.create.l HWIO_MSS_QDSP6SS_QTMR_V1_CNTVOFF_HI_2_ADDR A:0x6412301c
y.create.l HWIO_MSS_QDSP6SS_QTMR_V1_CNTP_CVAL_LO_2_ADDR A:0x64123020
y.create.l HWIO_MSS_QDSP6SS_QTMR_V1_CNTP_CVAL_HI_2_ADDR A:0x64123024
y.create.l HWIO_MSS_QDSP6SS_QTMR_V1_CNTP_TVAL_2_ADDR A:0x64123028
y.create.l HWIO_MSS_QDSP6SS_QTMR_V1_CNTP_CTL_2_ADDR A:0x6412302c
y.create.l HWIO_MSS_QDSP6SS_QTMR_V1_CNTV_CVAL_LO_2_ADDR A:0x64123030
y.create.l HWIO_MSS_QDSP6SS_QTMR_V1_CNTV_CVAL_HI_2_ADDR A:0x64123034
y.create.l HWIO_MSS_QDSP6SS_QTMR_V1_CNTV_TVAL_2_ADDR A:0x64123038
y.create.l HWIO_MSS_QDSP6SS_QTMR_V1_CNTV_CTL_2_ADDR A:0x6412303c
y.create.l HWIO_MSS_QDSP6SS_QTMR_V1_VERSION_2_ADDR A:0x64123fd0
y.create.l HWIO_MSS_QDSP6SS_SAW2_SECURE_ADDR A:0x64130000
y.create.l HWIO_MSS_QDSP6SS_SAW2_ID_ADDR A:0x64130004
y.create.l HWIO_MSS_QDSP6SS_SAW2_CFG_ADDR A:0x64130008
y.create.l HWIO_MSS_QDSP6SS_SAW2_SPM_STS_ADDR A:0x6413000c
y.create.l HWIO_MSS_QDSP6SS_SAW2_AVS_STS_ADDR A:0x64130010
y.create.l HWIO_MSS_QDSP6SS_SAW2_PMIC_STS_ADDR A:0x64130014
y.create.l HWIO_MSS_QDSP6SS_SAW2_RST_ADDR A:0x64130018
y.create.l HWIO_MSS_QDSP6SS_SAW2_VCTL_ADDR A:0x6413001c
y.create.l HWIO_MSS_QDSP6SS_SAW2_AVS_CTL_ADDR A:0x64130020
y.create.l HWIO_MSS_QDSP6SS_SAW2_AVS_LIMIT_ADDR A:0x64130024
y.create.l HWIO_MSS_QDSP6SS_SAW2_AVS_DLY_ADDR A:0x64130028
y.create.l HWIO_MSS_QDSP6SS_SAW2_AVS_HYSTERESIS_ADDR A:0x6413002c
y.create.l HWIO_MSS_QDSP6SS_SAW2_SPM_CTL_ADDR A:0x64130030
y.create.l HWIO_MSS_QDSP6SS_SAW2_SPM_DLY_ADDR A:0x64130034
y.create.l HWIO_MSS_QDSP6SS_SAW2_SPM_STS2_ADDR A:0x64130038
y.create.l HWIO_MSS_QDSP6SS_SAW2_SPM_SLP_SEQ_ENTRY_0_ADDR A:0x64130400
y.create.l HWIO_MSS_QDSP6SS_SAW2_SPM_SLP_SEQ_ENTRY_1_ADDR A:0x64130404
y.create.l HWIO_MSS_QDSP6SS_SAW2_SPM_SLP_SEQ_ENTRY_2_ADDR A:0x64130408
y.create.l HWIO_MSS_QDSP6SS_SAW2_SPM_SLP_SEQ_ENTRY_3_ADDR A:0x6413040c
y.create.l HWIO_MSS_QDSP6SS_SAW2_SPM_SLP_SEQ_ENTRY_4_ADDR A:0x64130410
y.create.l HWIO_MSS_QDSP6SS_SAW2_SPM_SLP_SEQ_ENTRY_5_ADDR A:0x64130414
y.create.l HWIO_MSS_QDSP6SS_SAW2_SPM_SLP_SEQ_ENTRY_6_ADDR A:0x64130418
y.create.l HWIO_MSS_QDSP6SS_SAW2_SPM_SLP_SEQ_ENTRY_7_ADDR A:0x6413041c
y.create.l HWIO_MSS_QDSP6SS_SAW2_SPM_SLP_SEQ_ENTRY_8_ADDR A:0x64130420
y.create.l HWIO_MSS_QDSP6SS_SAW2_SPM_SLP_SEQ_ENTRY_9_ADDR A:0x64130424
y.create.l HWIO_MSS_QDSP6SS_SAW2_SPM_PMIC_DATA_0_ADDR A:0x64130040
y.create.l HWIO_MSS_QDSP6SS_SAW2_SPM_PMIC_DATA_1_ADDR A:0x64130044
y.create.l HWIO_MSS_QDSP6SS_SAW2_SPM_PMIC_DATA_2_ADDR A:0x64130048
y.create.l HWIO_MSS_QDSP6SS_SAW2_SPM_PMIC_DATA_3_ADDR A:0x6413004c
y.create.l HWIO_MSS_QDSP6SS_SAW2_VERSION_ADDR A:0x64130fd0
y.create.l HWIO_MSS_QDSP6SS_ECS_HW_VERSION_ADDR A:0x64140000
y.create.l HWIO_MSS_QDSP6SS_ECS_CIRCULAR_BUF_WR_PTR_ADDR A:0x64140004
y.create.l HWIO_MSS_QDSP6SS_ECS_ACC_CODE_ADDR A:0x64140008
y.create.l HWIO_MSS_QDSP6SS_ECS_STATUS_ADDR A:0x6414000c
y.create.l HWIO_MSS_QDSP6SS_ECS_STATUS_1_ADDR A:0x64140010
y.create.l HWIO_MSS_QDSP6SS_ECS_CIRCULAR_BUF_0_ADDR A:0x64140020
y.create.l HWIO_MSS_QDSP6SS_ECS_CIRCULAR_BUF_1_ADDR A:0x64140024
y.create.l HWIO_MSS_QDSP6SS_ECS_CIRCULAR_BUF_2_ADDR A:0x64140028
y.create.l HWIO_MSS_QDSP6SS_ECS_CIRCULAR_BUF_3_ADDR A:0x6414002c
y.create.l HWIO_MSS_QDSP6SS_ECS_CIRCULAR_BUF_4_ADDR A:0x64140030
y.create.l HWIO_MSS_QDSP6SS_ECS_CIRCULAR_BUF_5_ADDR A:0x64140034
y.create.l HWIO_MSS_QDSP6SS_ECS_CIRCULAR_BUF_6_ADDR A:0x64140038
y.create.l HWIO_MSS_QDSP6SS_ECS_CIRCULAR_BUF_7_ADDR A:0x6414003c
y.create.l HWIO_MSS_QDSP6SS_ECS_CIRCULAR_BUF_8_ADDR A:0x64140040
y.create.l HWIO_MSS_QDSP6SS_ECS_CIRCULAR_BUF_9_ADDR A:0x64140044
y.create.l HWIO_MSS_QDSP6SS_ECS_CIRCULAR_BUF_10_ADDR A:0x64140048
y.create.l HWIO_MSS_QDSP6SS_ECS_CIRCULAR_BUF_11_ADDR A:0x6414004c
y.create.l HWIO_MSS_QDSP6SS_ECS_CIRCULAR_BUF_12_ADDR A:0x64140050
y.create.l HWIO_MSS_QDSP6SS_ECS_CIRCULAR_BUF_13_ADDR A:0x64140054
y.create.l HWIO_MSS_QDSP6SS_ECS_CIRCULAR_BUF_14_ADDR A:0x64140058
y.create.l HWIO_MSS_QDSP6SS_ECS_CIRCULAR_BUF_15_ADDR A:0x6414005c
y.create.l HWIO_MSS_QDSP6SS_ECS_ENABLE_FUSE_ADDR A:0x64140070
y.create.l HWIO_MSS_QDSP6SS_ECS_ENABLE_ADDR A:0x64140074
y.create.l HWIO_MSS_QDSP6SS_ECS_HALT_ADDR A:0x64140078
y.create.l HWIO_MSS_QDSP6SS_ECS_SENSOR_LDO_PARAMS_ADDR A:0x64140080
y.create.l HWIO_MSS_QDSP6SS_ECS_SENSOR_BHS_PARAMS_ADDR A:0x64140084
y.create.l HWIO_MSS_QDSP6SS_ECS_SENSOR_ANA_CTRL_ADDR A:0x64140088
y.create.l HWIO_MSS_QDSP6SS_ECS_SENSOR_WINDOW_ADDR A:0x64140090
y.create.l HWIO_MSS_QDSP6SS_ECS_TIMER_ADDR A:0x64140094
y.create.l HWIO_MSS_QDSP6SS_ECS_TST_CTRL_ADDR A:0x641400a0
y.create.l HWIO_MSS_QDSP6SS_ECS_INPUT_SELECT_COUNTER_ADDR A:0x641400a4
y.create.l HWIO_MSS_QDSP6SS_ECS_TEST_BUS_ADDR A:0x641400a8
y.create.l HWIO_MSS_QDSP6SS_ECS_FSM_CNT_ADDR A:0x641400ac
y.create.l HWIO_MSS_QDSP6SS_ECS_DEBUG0_ADDR A:0x641400b0
y.create.l HWIO_MSS_QDSP6SS_ECS_HALT_WAIT_CNT_ADDR A:0x641400b8
y.create.l HWIO_MSS_QDSP6SS_ECS_PREAMBLE_TIMER_CNT_ADDR A:0x641400bc
y.create.l HWIO_MSS_QDSP6SS_ECS_PADDED_DA_ADDR A:0x641400c0
y.create.l HWIO_MSS_RC_CONTROL_ADDR A:0x64200000
y.create.l HWIO_MSS_RC_CONFIG_ADDR A:0x64200004
y.create.l HWIO_MSS_RC_LPM_RTC_CONTROL_ADDR A:0x64200008
y.create.l HWIO_MSS_RC_PPSO_ASSERT_ADDR A:0x6420000c
y.create.l HWIO_MSS_RC_PPSO_DEASSERT_ADDR A:0x64200010
y.create.l HWIO_MSS_RC_GPS_ON_ADDR A:0x64200014
y.create.l HWIO_MSS_RC_TIME_TRANSFER_ADDR A:0x64200018
y.create.l HWIO_MSS_RC_GNSS_RTC_STATUS_ADDR A:0x6420001c
y.create.l HWIO_MSS_RC_BP1_COUNT_STATUS_ADDR A:0x64200020
y.create.l HWIO_MSS_RC_BP1_PHASE_STATUS_ADDR A:0x64200024
y.create.l HWIO_MSS_RC_BP2_COUNT_STATUS_ADDR A:0x64200028
y.create.l HWIO_MSS_RC_BP2_PHASE_STATUS_ADDR A:0x6420002c
y.create.l HWIO_MSS_RC_BP3_COUNT_STATUS_ADDR A:0x64200030
y.create.l HWIO_MSS_RC_BP3_PHASE_STATUS_ADDR A:0x64200034
y.create.l HWIO_MSS_RC_BP4_COUNT_STATUS_ADDR A:0x64200038
y.create.l HWIO_MSS_RC_BP4_PHASE_STATUS_ADDR A:0x6420003c
y.create.l HWIO_MSS_RC_TT_STATUS_ADDR A:0x64200040
y.create.l HWIO_MSS_RC_IRQ_STATUS_ADDR A:0x64200044
y.create.l HWIO_MSS_RC_PPSI_RTC_ADDR A:0x64200048
y.create.l HWIO_MSS_RC_NAV_TT_RTC_ADDR A:0x6420004c
y.create.l HWIO_MSS_RC_CDMA_TT_RTC_ADDR A:0x64200050
y.create.l HWIO_MSS_RC_GNSS_TT_CNT_ADDR A:0x64200054
y.create.l HWIO_MSS_RC_NAV_TEST_BUS_ADDR A:0x64200058
y.create.l HWIO_MSS_RC_B1_POLYNOMIAL_MASK_ADDR A:0x6420005c
y.create.l HWIO_MSS_AD_MODE_ADDR A:0x64200080
y.create.l HWIO_MSS_AD_RX1_CONFIG_ADDR A:0x64200084
y.create.l HWIO_MSS_AD_RX2_CONFIG_ADDR A:0x64200088
y.create.l HWIO_MSS_AD_RX1_QUANTMAP_ADDR A:0x6420008c
y.create.l HWIO_MSS_AD_RX2_QUANTMAP_ADDR A:0x64200090
y.create.l HWIO_MSS_AD_MEAS_STATUS_ADDR A:0x64200094
y.create.l HWIO_MSS_AD_RX1_MEAN_MON_ADDR A:0x64200098
y.create.l HWIO_MSS_AD_RX2_MEAN_MON_ADDR A:0x6420009c
y.create.l HWIO_MSS_AD_RX1_BLANK_MONITOR_ADDR A:0x642000a0
y.create.l HWIO_MSS_AD_RX2_BLANK_MONITOR_ADDR A:0x642000a4
y.create.l HWIO_MSS_AD_SL_INDEX_ADDR A:0x642000a8
y.create.l HWIO_MSS_AD_RX1_AMPL_MON_ADDR A:0x642000ac
y.create.l HWIO_MSS_AD_RX2_AMPL_MON_ADDR A:0x642000b0
y.create.l HWIO_MSS_AD_SPEC_ANALYZER_CMD_ADDR A:0x642000b4
y.create.l HWIO_MSS_AD_SPEC_ANALYZER_STATUS_ADDR A:0x642000b8
y.create.l HWIO_MSS_BP1_CONFIG_ADDR A:0x64200200
y.create.l HWIO_MSS_BP1_IF_FREQ_ADDR A:0x64200204
y.create.l HWIO_MSS_BP1_RS_RATE_ADDR A:0x64200208
y.create.l HWIO_MSS_BP1_OFFSET_ADDR A:0x6420020c
y.create.l HWIO_MSS_BP1_NOTCH1_ADDR A:0x64200210
y.create.l HWIO_MSS_BP1_NOTCH2_ADDR A:0x64200214
y.create.l HWIO_MSS_BP1_NOTCH3_ADDR A:0x64200218
y.create.l HWIO_MSS_BP1_NOTCH4_ADDR A:0x6420021c
y.create.l HWIO_MSS_BP1_NOTCH5_ADDR A:0x64200220
y.create.l HWIO_MSS_BP1_NOTCH6_ADDR A:0x64200224
y.create.l HWIO_MSS_BP1_EQ_COEF_REAL_ADDR A:0x64200228
y.create.l HWIO_MSS_BP1_EQ_COEF_IMAG_ADDR A:0x6420022c
y.create.l HWIO_MSS_BP1_FREQ_ADDR A:0x64200230
y.create.l HWIO_MSS_BP1_THRESH_ADDR A:0x64200234
y.create.l HWIO_MSS_BP1_PRE_NOTCH_ADDR A:0x64200238
y.create.l HWIO_MSS_BP1_RS_PHASE_ADDR A:0x6420023c
y.create.l HWIO_MSS_BP1_PRE_AMPL_MON_ADDR A:0x64200240
y.create.l HWIO_MSS_BP1_MEAN_MON_ADDR A:0x64200244
y.create.l HWIO_MSS_BP1_SCH2_AMPL_MON_ADDR A:0x64200248
y.create.l HWIO_MSS_BP1_SCH3_AMPL_MON_ADDR A:0x6420024c
y.create.l HWIO_MSS_BP2_CONFIG_ADDR A:0x64200300
y.create.l HWIO_MSS_BP2_IF_FREQ_ADDR A:0x64200304
y.create.l HWIO_MSS_BP2_RS_RATE_ADDR A:0x64200308
y.create.l HWIO_MSS_BP2_OFFSET_ADDR A:0x6420030c
y.create.l HWIO_MSS_BP2_NOTCH1_ADDR A:0x64200310
y.create.l HWIO_MSS_BP2_NOTCH2_ADDR A:0x64200314
y.create.l HWIO_MSS_BP2_NOTCH3_ADDR A:0x64200318
y.create.l HWIO_MSS_BP2_NOTCH4_ADDR A:0x6420031c
y.create.l HWIO_MSS_BP2_NOTCH5_ADDR A:0x64200320
y.create.l HWIO_MSS_BP2_NOTCH6_ADDR A:0x64200324
y.create.l HWIO_MSS_BP2_EQ_COEF_REAL_ADDR A:0x64200328
y.create.l HWIO_MSS_BP2_EQ_COEF_IMAG_ADDR A:0x6420032c
y.create.l HWIO_MSS_BP2_FREQ_ADDR A:0x64200330
y.create.l HWIO_MSS_BP2_THRESH_ADDR A:0x64200334
y.create.l HWIO_MSS_BP2_PRE_NOTCH_ADDR A:0x64200338
y.create.l HWIO_MSS_BP2_RS_PHASE_ADDR A:0x6420033c
y.create.l HWIO_MSS_BP2_PRE_AMPL_MON_ADDR A:0x64200340
y.create.l HWIO_MSS_BP2_MEAN_MON_ADDR A:0x64200344
y.create.l HWIO_MSS_BP2_SCH2_AMPL_MON_ADDR A:0x64200348
y.create.l HWIO_MSS_BP2_SCH3_AMPL_MON_ADDR A:0x6420034c
y.create.l HWIO_MSS_BP3_CONFIG_ADDR A:0x64200400
y.create.l HWIO_MSS_BP3_IF_FREQ_ADDR A:0x64200404
y.create.l HWIO_MSS_BP3_RS_RATE_ADDR A:0x64200408
y.create.l HWIO_MSS_BP3_OFFSET_ADDR A:0x6420040c
y.create.l HWIO_MSS_BP3_NOTCH1_ADDR A:0x64200410
y.create.l HWIO_MSS_BP3_NOTCH2_ADDR A:0x64200414
y.create.l HWIO_MSS_BP3_NOTCH3_ADDR A:0x64200418
y.create.l HWIO_MSS_BP3_NOTCH4_ADDR A:0x6420041c
y.create.l HWIO_MSS_BP3_NOTCH5_ADDR A:0x64200420
y.create.l HWIO_MSS_BP3_NOTCH6_ADDR A:0x64200424
y.create.l HWIO_MSS_BP3_EQ_COEF_REAL_ADDR A:0x64200428
y.create.l HWIO_MSS_BP3_EQ_COEF_IMAG_ADDR A:0x6420042c
y.create.l HWIO_MSS_BP3_RS_PHASE_ADDR A:0x64200430
y.create.l HWIO_MSS_BP3_SCH1_FREQ_ADDR A:0x64200434
y.create.l HWIO_MSS_BP3_SCH2_FREQ_ADDR A:0x64200438
y.create.l HWIO_MSS_BP3_SCH3_FREQ_ADDR A:0x6420043c
y.create.l HWIO_MSS_BP3_SCH4_FREQ_ADDR A:0x64200440
y.create.l HWIO_MSS_BP3_SCH5_FREQ_ADDR A:0x64200444
y.create.l HWIO_MSS_BP3_SCH6_FREQ_ADDR A:0x64200448
y.create.l HWIO_MSS_BP3_SCH7_FREQ_ADDR A:0x6420044c
y.create.l HWIO_MSS_BP3_SCH8_FREQ_ADDR A:0x64200450
y.create.l HWIO_MSS_BP3_SCH9_FREQ_ADDR A:0x64200454
y.create.l HWIO_MSS_BP3_SCH10_FREQ_ADDR A:0x64200458
y.create.l HWIO_MSS_BP3_SCH11_FREQ_ADDR A:0x6420045c
y.create.l HWIO_MSS_BP3_SCH12_FREQ_ADDR A:0x64200460
y.create.l HWIO_MSS_BP3_THRESH_A_ADDR A:0x64200464
y.create.l HWIO_MSS_BP3_THRESH_B_ADDR A:0x64200468
y.create.l HWIO_MSS_BP3_THRESH_C_ADDR A:0x6420046c
y.create.l HWIO_MSS_BP3_THRESH_D_ADDR A:0x64200470
y.create.l HWIO_MSS_BP3_THRESH_E_ADDR A:0x64200474
y.create.l HWIO_MSS_BP3_THRESH_F_ADDR A:0x64200478
y.create.l HWIO_MSS_BP3_PRE_AMPL_MON_ADDR A:0x6420047c
y.create.l HWIO_MSS_BP3_MEAN_MON_ADDR A:0x64200480
y.create.l HWIO_MSS_BP3_SCH1_AMPL_MON_ADDR A:0x64200484
y.create.l HWIO_MSS_BP3_SCH2_AMPL_MON_ADDR A:0x64200488
y.create.l HWIO_MSS_BP3_SCH3_AMPL_MON_ADDR A:0x6420048c
y.create.l HWIO_MSS_BP3_SCH4_AMPL_MON_ADDR A:0x64200490
y.create.l HWIO_MSS_BP3_SCH5_AMPL_MON_ADDR A:0x64200494
y.create.l HWIO_MSS_BP3_SCH6_AMPL_MON_ADDR A:0x64200498
y.create.l HWIO_MSS_BP3_SCH7_AMPL_MON_ADDR A:0x6420049c
y.create.l HWIO_MSS_BP3_SCH8_AMPL_MON_ADDR A:0x642004a0
y.create.l HWIO_MSS_BP3_SCH9_AMPL_MON_ADDR A:0x642004a4
y.create.l HWIO_MSS_BP3_SCH10_AMPL_MON_ADDR A:0x642004a8
y.create.l HWIO_MSS_BP3_SCH11_AMPL_MON_ADDR A:0x642004ac
y.create.l HWIO_MSS_BP3_SCH12_AMPL_MON_ADDR A:0x642004b0
y.create.l HWIO_MSS_BP3_SCH_MODE_ADDR A:0x642004b4
y.create.l HWIO_MSS_BP3_PRE_NOTCH_ADDR A:0x642004b8
y.create.l HWIO_MSS_BP3_NOTCH7_ADDR A:0x642004bc
y.create.l HWIO_MSS_BP3_NOTCH8_ADDR A:0x642004c0
y.create.l HWIO_MSS_BP3_NOTCH9_ADDR A:0x642004c4
y.create.l HWIO_MSS_BP3_NOTCH10_ADDR A:0x642004c8
y.create.l HWIO_MSS_BP3_NOTCH11_ADDR A:0x642004cc
y.create.l HWIO_MSS_BP3_NOTCH12_ADDR A:0x642004d0
y.create.l HWIO_MSS_BP4_CONFIG_ADDR A:0x64200500
y.create.l HWIO_MSS_BP4_IF_FREQ_ADDR A:0x64200504
y.create.l HWIO_MSS_BP4_RS_RATE_ADDR A:0x64200508
y.create.l HWIO_MSS_BP4_OFFSET_ADDR A:0x6420050c
y.create.l HWIO_MSS_BP4_NOTCH1_ADDR A:0x64200510
y.create.l HWIO_MSS_BP4_NOTCH2_ADDR A:0x64200514
y.create.l HWIO_MSS_BP4_NOTCH3_ADDR A:0x64200518
y.create.l HWIO_MSS_BP4_NOTCH4_ADDR A:0x6420051c
y.create.l HWIO_MSS_BP4_NOTCH5_ADDR A:0x64200520
y.create.l HWIO_MSS_BP4_NOTCH6_ADDR A:0x64200524
y.create.l HWIO_MSS_BP4_EQ_COEF_REAL_ADDR A:0x64200528
y.create.l HWIO_MSS_BP4_EQ_COEF_IMAG_ADDR A:0x6420052c
y.create.l HWIO_MSS_BP4_FREQ_ADDR A:0x64200530
y.create.l HWIO_MSS_BP4_THRESH_ADDR A:0x64200534
y.create.l HWIO_MSS_BP4_RS_PHASE_ADDR A:0x64200538
y.create.l HWIO_MSS_BP4_PRE_AMPL_MON_ADDR A:0x6420053c
y.create.l HWIO_MSS_BP4_MEAN_MON_ADDR A:0x64200540
y.create.l HWIO_MSS_BP4_AMPL_MON_ADDR A:0x64200544
y.create.l HWIO_MSS_BP4_PRE_NOTCH_ADDR A:0x64200548
y.create.l HWIO_MSS_LTE1_CONFIG_ADDR A:0x642002e0
y.create.l HWIO_MSS_LTE1_IF_FREQ_ADDR A:0x642002e4
y.create.l HWIO_MSS_LTE3_CONFIG_ADDR A:0x642004e0
y.create.l HWIO_MSS_LTE3_IF_FREQ_ADDR A:0x642004e4
y.create.l HWIO_MSS_TSG_CMD0_ADDR A:0x64200100
y.create.l HWIO_MSS_TSG_CH1_CONFIG_ADDR A:0x64200104
y.create.l HWIO_MSS_TSG_CH1_RS_RATE_ADDR A:0x64200108
y.create.l HWIO_MSS_TSG_CH1_INIT_COUNT_ADDR A:0x6420010c
y.create.l HWIO_MSS_TSG_CH1_FREQ_ADDR A:0x64200110
y.create.l HWIO_MSS_TSG_CH1_DATA_SEED_ADDR A:0x64200114
y.create.l HWIO_MSS_TSG_CH1_PILOT_SEED_ADDR A:0x64200118
y.create.l HWIO_MSS_TSG_CH2_CONFIG_ADDR A:0x6420011c
y.create.l HWIO_MSS_TSG_CH2_RS_RATE_ADDR A:0x64200120
y.create.l HWIO_MSS_TSG_CH2_INIT_COUNT_ADDR A:0x64200124
y.create.l HWIO_MSS_TSG_CH2_FREQ_ADDR A:0x64200128
y.create.l HWIO_MSS_TSG_CH2_DATA_SEED_ADDR A:0x6420012c
y.create.l HWIO_MSS_TSG_CH2_PILOT_SEED_ADDR A:0x64200130
y.create.l HWIO_MSS_TSG_RX1_CONFIG_ADDR A:0x64200134
y.create.l HWIO_MSS_TSG_RX1_OFFSET_ADDR A:0x64200138
y.create.l HWIO_MSS_TSG_RX2_CONFIG_ADDR A:0x6420013c
y.create.l HWIO_MSS_TSG_RX2_OFFSET_ADDR A:0x64200140
y.create.l HWIO_MSS_TSG_FIRST_CODE_ADDR A:0x64200144
y.create.l HWIO_MSS_TSG_CH1_COUNT_STATUS_ADDR A:0x64200148
y.create.l HWIO_MSS_TSG_CH2_COUNT_STATUS_ADDR A:0x6420014c
y.create.l HWIO_MSS_SMI_MODE_ADDR A:0x64200600
y.create.l HWIO_MSS_SMI_BASEADDR1_ADDR A:0x64200604
y.create.l HWIO_MSS_SMI_BASEADDR2_ADDR A:0x64200608
y.create.l HWIO_MSS_SMI_BASEADDR3A_ADDR A:0x6420060c
y.create.l HWIO_MSS_SMI_BASEADDR3B_ADDR A:0x64200610
y.create.l HWIO_MSS_SMI_BASEADDR3C_ADDR A:0x64200614
y.create.l HWIO_MSS_SMI_BASEADDR4_ADDR A:0x64200618
y.create.l HWIO_MSS_CP_START_ADDR A:0x64200700
y.create.l HWIO_MSS_CP_CONFIG1_ADDR A:0x64200704
y.create.l HWIO_MSS_CP_CONFIG2_ADDR A:0x64200708
y.create.l HWIO_MSS_CP_SAMPLE_INDEX_ADDR A:0x6420070c
y.create.l HWIO_MSS_CP_PHASE_ADDR A:0x64200710
y.create.l HWIO_MSS_CP_FREQ_ADDR A:0x64200714
y.create.l HWIO_MSS_CP_DATA_SEED_ADDR A:0x64200718
y.create.l HWIO_MSS_CP_PILOT_SEED_ADDR A:0x6420071c
y.create.l HWIO_MSS_CP_CODE_INDEX_ADDR A:0x64200720
y.create.l HWIO_MSS_CP_COEF1_ADDR A:0x64200724
y.create.l HWIO_MSS_CP_COEF2_ADDR A:0x64200728
y.create.l HWIO_MSS_CP_COEF3_ADDR A:0x6420072c
y.create.l HWIO_MSS_CP_COEF4_ADDR A:0x64200730
y.create.l HWIO_MSS_CP_COEF5_ADDR A:0x64200734
y.create.l HWIO_MSS_CP_COEF6_ADDR A:0x64200738
y.create.l HWIO_MSS_CP_STATUS_ADDR A:0x6420073c
y.create.l HWIO_MSS_CCP_BREAKPOINT_ADDR A:0x64200800
y.create.l HWIO_MSS_CCP_BREAK_STATE_ADDR A:0x64200804
y.create.l HWIO_MSS_CCP_PROG_STATUS_ADDR A:0x64200808
y.create.l HWIO_MSS_CCP_G10_STATUS_ADDR A:0x6420080c
y.create.l HWIO_MSS_CCP_G32_STATUS_ADDR A:0x64200810
y.create.l HWIO_MSS_CCP_G54_STATUS_ADDR A:0x64200814
y.create.l HWIO_MSS_CCP_G76_STATUS_ADDR A:0x64200818
y.create.l HWIO_MSS_CCP_P10_STATUS_ADDR A:0x6420081c
y.create.l HWIO_MSS_CCP_P2_STATUS_ADDR A:0x64200820
y.create.l HWIO_MSS_SM_ADDR_BEGIN_ADDR A:0x64240000
y.create.l HWIO_MSS_SM_ADDR_END_ADDR A:0x64256ffc
y.create.l HWIO_MSS_GPM_ADDR_BEGIN_ADDR A:0x64204000
y.create.l HWIO_MSS_GPM_ADDR_END_ADDR A:0x642047fc
y.create.l HWIO_MSS_GDM_ADDR_BEGIN_ADDR A:0x64208000
y.create.l HWIO_MSS_GDM_ADDR_END_ADDR A:0x642087fc
y.create.l HWIO_MSS_CMA_ADDR_BEGIN_ADDR A:0x6420c000
y.create.l HWIO_MSS_CMA_ADDR_END_ADDR A:0x6420edfc
y.create.l HWIO_MSS_CMB_ADDR_BEGIN_ADDR A:0x64210000
y.create.l HWIO_MSS_CMB_ADDR_END_ADDR A:0x64212dfc
y.create.l HWIO_MSS_VM_ADDR_BEGIN_ADDR A:0x64218000
y.create.l HWIO_MSS_VM_ADDR_END_ADDR A:0x64218ffc
y.create.l HWIO_MSS_PM_ADDR_BEGIN_ADDR A:0x6421c000
y.create.l HWIO_MSS_PM_ADDR_END_ADDR A:0x6421cffc
y.create.l HWIO_MSS_CCM_START_CMD_ADDR A:0x64214000
y.create.l HWIO_MSS_CCM_WORD1_CMD_ADDR A:0x64214004
y.create.l HWIO_MSS_CCM_WORD2_CMD_ADDR A:0x64214008
y.create.l HWIO_MSS_CCM_WORD3_CMD_ADDR A:0x6421400c
y.create.l HWIO_MSS_CCM_WORD4_CMD_ADDR A:0x64214010
y.create.l HWIO_MSS_CCM_WORD5_CMD_ADDR A:0x64214014
y.create.l HWIO_MSS_CCM_WORD6_CMD_ADDR A:0x64214018
y.create.l HWIO_MSS_CCM_WORD7_CMD_ADDR A:0x6421401c
y.create.l HWIO_MSS_CCM_END_CMD_ADDR A:0x64214020
y.create.l HWIO_MSS_CCM_STOP_CMD_ADDR A:0x642147dc
y.create.l HWIO_MSS_CCM_LOAD_CMD_ADDR A:0x642147e0
y.create.l HWIO_MSS_CCM_ERROR_CLEAR_CMD_ADDR A:0x642147e4
y.create.l HWIO_MSS_CCM_TIME_MARGIN_CMD_ADDR A:0x642147e8
y.create.l HWIO_MSS_CCM_LATE_TASK_ERROR_STATUS_ADDR A:0x642147ec
y.create.l HWIO_MSS_CCM_OVERRUN_ERROR_STATUS_ADDR A:0x642147f0
y.create.l HWIO_MSS_CCM_SEQ_NUMBER_STATUS_ADDR A:0x642147f4
y.create.l HWIO_MSS_CCM_DONE_RTC_STATUS_ADDR A:0x642147f8
y.create.l HWIO_MSS_CCM_STALL_COUNT_STATUS_ADDR A:0x642147fc
y.create.l HWIO_MSS_TPM_ADDR_BEGIN_ADDR A:0x64220000
y.create.l HWIO_MSS_TPM_ADDR_END_ADDR A:0x642201fc
y.create.l HWIO_MSS_TDM_ADDR_BEGIN_ADDR A:0x64224000
y.create.l HWIO_MSS_TDM_ADDR_END_ADDR A:0x642241fc
y.create.l HWIO_MSS_GACC_CLK_CTL_ADDR A:0x64200a00
y.create.l HWIO_MSS_GACC_RTC_WAIT_ADDR A:0x64200a04
y.create.l HWIO_MSS_GACC_START_ADDR_ADDR A:0x64200a08
y.create.l HWIO_MSS_GACC_COUNT_ADDR A:0x64200a0c
y.create.l HWIO_MSS_GACC_INCR_ADDR A:0x64200a10
y.create.l HWIO_MSS_GACC_FREQ_ADDR A:0x64200a14
y.create.l HWIO_MSS_GACC_CONFIG_ADDR A:0x64200a18
y.create.l HWIO_MSS_GACC_PEAK_ADDR A:0x64200a1c
y.create.l HWIO_MSS_GACC_DONE_ADDR A:0x64200a20
y.create.l HWIO_MSS_GACC_RTC_ADDR A:0x64200a24
y.create.l HWIO_MSS_GACC_TEST_BUS_OUT_ADDR A:0x64200a28
y.create.l HWIO_MSS_GACC_SAMPLE_MEM_START_ADDR_ADDR A:0x64228000
y.create.l HWIO_MSS_GACC_SAMPLE_MEM_END_ADDR_ADDR A:0x642289fc
y.create.l HWIO_MSS_GACC_ENERGY_MEM_START_ADDR_ADDR A:0x6422c000
y.create.l HWIO_MSS_GACC_ENERGY_MEM_END_ADDR_ADDR A:0x6422c9fc
y.create.l HWIO_MSS_HI0_CH0_CMD_PTR_SD0_ADDR A:0x64200b00
y.create.l HWIO_MSS_HI0_CH0_CMD_PTR_SD1_ADDR A:0x64200f00
y.create.l HWIO_MSS_HI0_CH0_CMD_PTR_SD2_ADDR A:0x64201300
y.create.l HWIO_MSS_HI0_CH0_CMD_PTR_SD3_ADDR A:0x64201700
y.create.l HWIO_MSS_HI0_CH1_CMD_PTR_SD0_ADDR A:0x64200b04
y.create.l HWIO_MSS_HI0_CH1_CMD_PTR_SD1_ADDR A:0x64200f04
y.create.l HWIO_MSS_HI0_CH1_CMD_PTR_SD2_ADDR A:0x64201304
y.create.l HWIO_MSS_HI0_CH1_CMD_PTR_SD3_ADDR A:0x64201704
y.create.l HWIO_MSS_HI0_CH2_CMD_PTR_SD0_ADDR A:0x64200b08
y.create.l HWIO_MSS_HI0_CH2_CMD_PTR_SD1_ADDR A:0x64200f08
y.create.l HWIO_MSS_HI0_CH2_CMD_PTR_SD2_ADDR A:0x64201308
y.create.l HWIO_MSS_HI0_CH2_CMD_PTR_SD3_ADDR A:0x64201708
y.create.l HWIO_MSS_HI0_CH3_CMD_PTR_SD0_ADDR A:0x64200b0c
y.create.l HWIO_MSS_HI0_CH3_CMD_PTR_SD1_ADDR A:0x64200f0c
y.create.l HWIO_MSS_HI0_CH3_CMD_PTR_SD2_ADDR A:0x6420130c
y.create.l HWIO_MSS_HI0_CH3_CMD_PTR_SD3_ADDR A:0x6420170c
y.create.l HWIO_MSS_HI0_CH4_CMD_PTR_SD0_ADDR A:0x64200b10
y.create.l HWIO_MSS_HI0_CH4_CMD_PTR_SD1_ADDR A:0x64200f10
y.create.l HWIO_MSS_HI0_CH4_CMD_PTR_SD2_ADDR A:0x64201310
y.create.l HWIO_MSS_HI0_CH4_CMD_PTR_SD3_ADDR A:0x64201710
y.create.l HWIO_MSS_HI0_CH5_CMD_PTR_SD0_ADDR A:0x64200b14
y.create.l HWIO_MSS_HI0_CH5_CMD_PTR_SD1_ADDR A:0x64200f14
y.create.l HWIO_MSS_HI0_CH5_CMD_PTR_SD2_ADDR A:0x64201314
y.create.l HWIO_MSS_HI0_CH5_CMD_PTR_SD3_ADDR A:0x64201714
y.create.l HWIO_MSS_HI0_CH6_CMD_PTR_SD0_ADDR A:0x64200b18
y.create.l HWIO_MSS_HI0_CH6_CMD_PTR_SD1_ADDR A:0x64200f18
y.create.l HWIO_MSS_HI0_CH6_CMD_PTR_SD2_ADDR A:0x64201318
y.create.l HWIO_MSS_HI0_CH6_CMD_PTR_SD3_ADDR A:0x64201718
y.create.l HWIO_MSS_HI0_CH7_CMD_PTR_SD0_ADDR A:0x64200b1c
y.create.l HWIO_MSS_HI0_CH7_CMD_PTR_SD1_ADDR A:0x64200f1c
y.create.l HWIO_MSS_HI0_CH7_CMD_PTR_SD2_ADDR A:0x6420131c
y.create.l HWIO_MSS_HI0_CH7_CMD_PTR_SD3_ADDR A:0x6420171c
y.create.l HWIO_MSS_HI0_CH0_RSLT_SD0_ADDR A:0x64200b40
y.create.l HWIO_MSS_HI0_CH0_RSLT_SD1_ADDR A:0x64200f40
y.create.l HWIO_MSS_HI0_CH0_RSLT_SD2_ADDR A:0x64201340
y.create.l HWIO_MSS_HI0_CH0_RSLT_SD3_ADDR A:0x64201740
y.create.l HWIO_MSS_HI0_CH1_RSLT_SD0_ADDR A:0x64200b44
y.create.l HWIO_MSS_HI0_CH1_RSLT_SD1_ADDR A:0x64200f44
y.create.l HWIO_MSS_HI0_CH1_RSLT_SD2_ADDR A:0x64201344
y.create.l HWIO_MSS_HI0_CH1_RSLT_SD3_ADDR A:0x64201744
y.create.l HWIO_MSS_HI0_CH2_RSLT_SD0_ADDR A:0x64200b48
y.create.l HWIO_MSS_HI0_CH2_RSLT_SD1_ADDR A:0x64200f48
y.create.l HWIO_MSS_HI0_CH2_RSLT_SD2_ADDR A:0x64201348
y.create.l HWIO_MSS_HI0_CH2_RSLT_SD3_ADDR A:0x64201748
y.create.l HWIO_MSS_HI0_CH3_RSLT_SD0_ADDR A:0x64200b4c
y.create.l HWIO_MSS_HI0_CH3_RSLT_SD1_ADDR A:0x64200f4c
y.create.l HWIO_MSS_HI0_CH3_RSLT_SD2_ADDR A:0x6420134c
y.create.l HWIO_MSS_HI0_CH3_RSLT_SD3_ADDR A:0x6420174c
y.create.l HWIO_MSS_HI0_CH4_RSLT_SD0_ADDR A:0x64200b50
y.create.l HWIO_MSS_HI0_CH4_RSLT_SD1_ADDR A:0x64200f50
y.create.l HWIO_MSS_HI0_CH4_RSLT_SD2_ADDR A:0x64201350
y.create.l HWIO_MSS_HI0_CH4_RSLT_SD3_ADDR A:0x64201750
y.create.l HWIO_MSS_HI0_CH5_RSLT_SD0_ADDR A:0x64200b54
y.create.l HWIO_MSS_HI0_CH5_RSLT_SD1_ADDR A:0x64200f54
y.create.l HWIO_MSS_HI0_CH5_RSLT_SD2_ADDR A:0x64201354
y.create.l HWIO_MSS_HI0_CH5_RSLT_SD3_ADDR A:0x64201754
y.create.l HWIO_MSS_HI0_CH6_RSLT_SD0_ADDR A:0x64200b58
y.create.l HWIO_MSS_HI0_CH6_RSLT_SD1_ADDR A:0x64200f58
y.create.l HWIO_MSS_HI0_CH6_RSLT_SD2_ADDR A:0x64201358
y.create.l HWIO_MSS_HI0_CH6_RSLT_SD3_ADDR A:0x64201758
y.create.l HWIO_MSS_HI0_CH7_RSLT_SD0_ADDR A:0x64200b5c
y.create.l HWIO_MSS_HI0_CH7_RSLT_SD1_ADDR A:0x64200f5c
y.create.l HWIO_MSS_HI0_CH7_RSLT_SD2_ADDR A:0x6420135c
y.create.l HWIO_MSS_HI0_CH7_RSLT_SD3_ADDR A:0x6420175c
y.create.l HWIO_MSS_HI0_CH0_FLUSH_STATE0_SD0_ADDR A:0x64200b80
y.create.l HWIO_MSS_HI0_CH0_FLUSH_STATE0_SD1_ADDR A:0x64200f80
y.create.l HWIO_MSS_HI0_CH0_FLUSH_STATE0_SD2_ADDR A:0x64201380
y.create.l HWIO_MSS_HI0_CH0_FLUSH_STATE0_SD3_ADDR A:0x64201780
y.create.l HWIO_MSS_HI0_CH1_FLUSH_STATE0_SD0_ADDR A:0x64200b84
y.create.l HWIO_MSS_HI0_CH1_FLUSH_STATE0_SD1_ADDR A:0x64200f84
y.create.l HWIO_MSS_HI0_CH1_FLUSH_STATE0_SD2_ADDR A:0x64201384
y.create.l HWIO_MSS_HI0_CH1_FLUSH_STATE0_SD3_ADDR A:0x64201784
y.create.l HWIO_MSS_HI0_CH2_FLUSH_STATE0_SD0_ADDR A:0x64200b88
y.create.l HWIO_MSS_HI0_CH2_FLUSH_STATE0_SD1_ADDR A:0x64200f88
y.create.l HWIO_MSS_HI0_CH2_FLUSH_STATE0_SD2_ADDR A:0x64201388
y.create.l HWIO_MSS_HI0_CH2_FLUSH_STATE0_SD3_ADDR A:0x64201788
y.create.l HWIO_MSS_HI0_CH3_FLUSH_STATE0_SD0_ADDR A:0x64200b8c
y.create.l HWIO_MSS_HI0_CH3_FLUSH_STATE0_SD1_ADDR A:0x64200f8c
y.create.l HWIO_MSS_HI0_CH3_FLUSH_STATE0_SD2_ADDR A:0x6420138c
y.create.l HWIO_MSS_HI0_CH3_FLUSH_STATE0_SD3_ADDR A:0x6420178c
y.create.l HWIO_MSS_HI0_CH4_FLUSH_STATE0_SD0_ADDR A:0x64200b90
y.create.l HWIO_MSS_HI0_CH4_FLUSH_STATE0_SD1_ADDR A:0x64200f90
y.create.l HWIO_MSS_HI0_CH4_FLUSH_STATE0_SD2_ADDR A:0x64201390
y.create.l HWIO_MSS_HI0_CH4_FLUSH_STATE0_SD3_ADDR A:0x64201790
y.create.l HWIO_MSS_HI0_CH5_FLUSH_STATE0_SD0_ADDR A:0x64200b94
y.create.l HWIO_MSS_HI0_CH5_FLUSH_STATE0_SD1_ADDR A:0x64200f94
y.create.l HWIO_MSS_HI0_CH5_FLUSH_STATE0_SD2_ADDR A:0x64201394
y.create.l HWIO_MSS_HI0_CH5_FLUSH_STATE0_SD3_ADDR A:0x64201794
y.create.l HWIO_MSS_HI0_CH6_FLUSH_STATE0_SD0_ADDR A:0x64200b98
y.create.l HWIO_MSS_HI0_CH6_FLUSH_STATE0_SD1_ADDR A:0x64200f98
y.create.l HWIO_MSS_HI0_CH6_FLUSH_STATE0_SD2_ADDR A:0x64201398
y.create.l HWIO_MSS_HI0_CH6_FLUSH_STATE0_SD3_ADDR A:0x64201798
y.create.l HWIO_MSS_HI0_CH7_FLUSH_STATE0_SD0_ADDR A:0x64200b9c
y.create.l HWIO_MSS_HI0_CH7_FLUSH_STATE0_SD1_ADDR A:0x64200f9c
y.create.l HWIO_MSS_HI0_CH7_FLUSH_STATE0_SD2_ADDR A:0x6420139c
y.create.l HWIO_MSS_HI0_CH7_FLUSH_STATE0_SD3_ADDR A:0x6420179c
y.create.l HWIO_MSS_HI0_CH0_FLUSH_STATE1_SD0_ADDR A:0x64200bc0
y.create.l HWIO_MSS_HI0_CH0_FLUSH_STATE1_SD1_ADDR A:0x64200fc0
y.create.l HWIO_MSS_HI0_CH0_FLUSH_STATE1_SD2_ADDR A:0x642013c0
y.create.l HWIO_MSS_HI0_CH0_FLUSH_STATE1_SD3_ADDR A:0x642017c0
y.create.l HWIO_MSS_HI0_CH1_FLUSH_STATE1_SD0_ADDR A:0x64200bc4
y.create.l HWIO_MSS_HI0_CH1_FLUSH_STATE1_SD1_ADDR A:0x64200fc4
y.create.l HWIO_MSS_HI0_CH1_FLUSH_STATE1_SD2_ADDR A:0x642013c4
y.create.l HWIO_MSS_HI0_CH1_FLUSH_STATE1_SD3_ADDR A:0x642017c4
y.create.l HWIO_MSS_HI0_CH2_FLUSH_STATE1_SD0_ADDR A:0x64200bc8
y.create.l HWIO_MSS_HI0_CH2_FLUSH_STATE1_SD1_ADDR A:0x64200fc8
y.create.l HWIO_MSS_HI0_CH2_FLUSH_STATE1_SD2_ADDR A:0x642013c8
y.create.l HWIO_MSS_HI0_CH2_FLUSH_STATE1_SD3_ADDR A:0x642017c8
y.create.l HWIO_MSS_HI0_CH3_FLUSH_STATE1_SD0_ADDR A:0x64200bcc
y.create.l HWIO_MSS_HI0_CH3_FLUSH_STATE1_SD1_ADDR A:0x64200fcc
y.create.l HWIO_MSS_HI0_CH3_FLUSH_STATE1_SD2_ADDR A:0x642013cc
y.create.l HWIO_MSS_HI0_CH3_FLUSH_STATE1_SD3_ADDR A:0x642017cc
y.create.l HWIO_MSS_HI0_CH4_FLUSH_STATE1_SD0_ADDR A:0x64200bd0
y.create.l HWIO_MSS_HI0_CH4_FLUSH_STATE1_SD1_ADDR A:0x64200fd0
y.create.l HWIO_MSS_HI0_CH4_FLUSH_STATE1_SD2_ADDR A:0x642013d0
y.create.l HWIO_MSS_HI0_CH4_FLUSH_STATE1_SD3_ADDR A:0x642017d0
y.create.l HWIO_MSS_HI0_CH5_FLUSH_STATE1_SD0_ADDR A:0x64200bd4
y.create.l HWIO_MSS_HI0_CH5_FLUSH_STATE1_SD1_ADDR A:0x64200fd4
y.create.l HWIO_MSS_HI0_CH5_FLUSH_STATE1_SD2_ADDR A:0x642013d4
y.create.l HWIO_MSS_HI0_CH5_FLUSH_STATE1_SD3_ADDR A:0x642017d4
y.create.l HWIO_MSS_HI0_CH6_FLUSH_STATE1_SD0_ADDR A:0x64200bd8
y.create.l HWIO_MSS_HI0_CH6_FLUSH_STATE1_SD1_ADDR A:0x64200fd8
y.create.l HWIO_MSS_HI0_CH6_FLUSH_STATE1_SD2_ADDR A:0x642013d8
y.create.l HWIO_MSS_HI0_CH6_FLUSH_STATE1_SD3_ADDR A:0x642017d8
y.create.l HWIO_MSS_HI0_CH7_FLUSH_STATE1_SD0_ADDR A:0x64200bdc
y.create.l HWIO_MSS_HI0_CH7_FLUSH_STATE1_SD1_ADDR A:0x64200fdc
y.create.l HWIO_MSS_HI0_CH7_FLUSH_STATE1_SD2_ADDR A:0x642013dc
y.create.l HWIO_MSS_HI0_CH7_FLUSH_STATE1_SD3_ADDR A:0x642017dc
y.create.l HWIO_MSS_HI0_CH0_FLUSH_STATE3_SD0_ADDR A:0x64200c40
y.create.l HWIO_MSS_HI0_CH0_FLUSH_STATE3_SD1_ADDR A:0x64201040
y.create.l HWIO_MSS_HI0_CH0_FLUSH_STATE3_SD2_ADDR A:0x64201440
y.create.l HWIO_MSS_HI0_CH0_FLUSH_STATE3_SD3_ADDR A:0x64201840
y.create.l HWIO_MSS_HI0_CH1_FLUSH_STATE3_SD0_ADDR A:0x64200c44
y.create.l HWIO_MSS_HI0_CH1_FLUSH_STATE3_SD1_ADDR A:0x64201044
y.create.l HWIO_MSS_HI0_CH1_FLUSH_STATE3_SD2_ADDR A:0x64201444
y.create.l HWIO_MSS_HI0_CH1_FLUSH_STATE3_SD3_ADDR A:0x64201844
y.create.l HWIO_MSS_HI0_CH2_FLUSH_STATE3_SD0_ADDR A:0x64200c48
y.create.l HWIO_MSS_HI0_CH2_FLUSH_STATE3_SD1_ADDR A:0x64201048
y.create.l HWIO_MSS_HI0_CH2_FLUSH_STATE3_SD2_ADDR A:0x64201448
y.create.l HWIO_MSS_HI0_CH2_FLUSH_STATE3_SD3_ADDR A:0x64201848
y.create.l HWIO_MSS_HI0_CH3_FLUSH_STATE3_SD0_ADDR A:0x64200c4c
y.create.l HWIO_MSS_HI0_CH3_FLUSH_STATE3_SD1_ADDR A:0x6420104c
y.create.l HWIO_MSS_HI0_CH3_FLUSH_STATE3_SD2_ADDR A:0x6420144c
y.create.l HWIO_MSS_HI0_CH3_FLUSH_STATE3_SD3_ADDR A:0x6420184c
y.create.l HWIO_MSS_HI0_CH4_FLUSH_STATE3_SD0_ADDR A:0x64200c50
y.create.l HWIO_MSS_HI0_CH4_FLUSH_STATE3_SD1_ADDR A:0x64201050
y.create.l HWIO_MSS_HI0_CH4_FLUSH_STATE3_SD2_ADDR A:0x64201450
y.create.l HWIO_MSS_HI0_CH4_FLUSH_STATE3_SD3_ADDR A:0x64201850
y.create.l HWIO_MSS_HI0_CH5_FLUSH_STATE3_SD0_ADDR A:0x64200c54
y.create.l HWIO_MSS_HI0_CH5_FLUSH_STATE3_SD1_ADDR A:0x64201054
y.create.l HWIO_MSS_HI0_CH5_FLUSH_STATE3_SD2_ADDR A:0x64201454
y.create.l HWIO_MSS_HI0_CH5_FLUSH_STATE3_SD3_ADDR A:0x64201854
y.create.l HWIO_MSS_HI0_CH6_FLUSH_STATE3_SD0_ADDR A:0x64200c58
y.create.l HWIO_MSS_HI0_CH6_FLUSH_STATE3_SD1_ADDR A:0x64201058
y.create.l HWIO_MSS_HI0_CH6_FLUSH_STATE3_SD2_ADDR A:0x64201458
y.create.l HWIO_MSS_HI0_CH6_FLUSH_STATE3_SD3_ADDR A:0x64201858
y.create.l HWIO_MSS_HI0_CH7_FLUSH_STATE3_SD0_ADDR A:0x64200c5c
y.create.l HWIO_MSS_HI0_CH7_FLUSH_STATE3_SD1_ADDR A:0x6420105c
y.create.l HWIO_MSS_HI0_CH7_FLUSH_STATE3_SD2_ADDR A:0x6420145c
y.create.l HWIO_MSS_HI0_CH7_FLUSH_STATE3_SD3_ADDR A:0x6420185c
y.create.l HWIO_MSS_HI0_CH0_FLUSH_STATE4_SD0_ADDR A:0x64200c80
y.create.l HWIO_MSS_HI0_CH0_FLUSH_STATE4_SD1_ADDR A:0x64201080
y.create.l HWIO_MSS_HI0_CH0_FLUSH_STATE4_SD2_ADDR A:0x64201480
y.create.l HWIO_MSS_HI0_CH0_FLUSH_STATE4_SD3_ADDR A:0x64201880
y.create.l HWIO_MSS_HI0_CH1_FLUSH_STATE4_SD0_ADDR A:0x64200c84
y.create.l HWIO_MSS_HI0_CH1_FLUSH_STATE4_SD1_ADDR A:0x64201084
y.create.l HWIO_MSS_HI0_CH1_FLUSH_STATE4_SD2_ADDR A:0x64201484
y.create.l HWIO_MSS_HI0_CH1_FLUSH_STATE4_SD3_ADDR A:0x64201884
y.create.l HWIO_MSS_HI0_CH2_FLUSH_STATE4_SD0_ADDR A:0x64200c88
y.create.l HWIO_MSS_HI0_CH2_FLUSH_STATE4_SD1_ADDR A:0x64201088
y.create.l HWIO_MSS_HI0_CH2_FLUSH_STATE4_SD2_ADDR A:0x64201488
y.create.l HWIO_MSS_HI0_CH2_FLUSH_STATE4_SD3_ADDR A:0x64201888
y.create.l HWIO_MSS_HI0_CH3_FLUSH_STATE4_SD0_ADDR A:0x64200c8c
y.create.l HWIO_MSS_HI0_CH3_FLUSH_STATE4_SD1_ADDR A:0x6420108c
y.create.l HWIO_MSS_HI0_CH3_FLUSH_STATE4_SD2_ADDR A:0x6420148c
y.create.l HWIO_MSS_HI0_CH3_FLUSH_STATE4_SD3_ADDR A:0x6420188c
y.create.l HWIO_MSS_HI0_CH4_FLUSH_STATE4_SD0_ADDR A:0x64200c90
y.create.l HWIO_MSS_HI0_CH4_FLUSH_STATE4_SD1_ADDR A:0x64201090
y.create.l HWIO_MSS_HI0_CH4_FLUSH_STATE4_SD2_ADDR A:0x64201490
y.create.l HWIO_MSS_HI0_CH4_FLUSH_STATE4_SD3_ADDR A:0x64201890
y.create.l HWIO_MSS_HI0_CH5_FLUSH_STATE4_SD0_ADDR A:0x64200c94
y.create.l HWIO_MSS_HI0_CH5_FLUSH_STATE4_SD1_ADDR A:0x64201094
y.create.l HWIO_MSS_HI0_CH5_FLUSH_STATE4_SD2_ADDR A:0x64201494
y.create.l HWIO_MSS_HI0_CH5_FLUSH_STATE4_SD3_ADDR A:0x64201894
y.create.l HWIO_MSS_HI0_CH6_FLUSH_STATE4_SD0_ADDR A:0x64200c98
y.create.l HWIO_MSS_HI0_CH6_FLUSH_STATE4_SD1_ADDR A:0x64201098
y.create.l HWIO_MSS_HI0_CH6_FLUSH_STATE4_SD2_ADDR A:0x64201498
y.create.l HWIO_MSS_HI0_CH6_FLUSH_STATE4_SD3_ADDR A:0x64201898
y.create.l HWIO_MSS_HI0_CH7_FLUSH_STATE4_SD0_ADDR A:0x64200c9c
y.create.l HWIO_MSS_HI0_CH7_FLUSH_STATE4_SD1_ADDR A:0x6420109c
y.create.l HWIO_MSS_HI0_CH7_FLUSH_STATE4_SD2_ADDR A:0x6420149c
y.create.l HWIO_MSS_HI0_CH7_FLUSH_STATE4_SD3_ADDR A:0x6420189c
y.create.l HWIO_MSS_HI0_CH0_FLUSH_STATE5_SD0_ADDR A:0x64200cc0
y.create.l HWIO_MSS_HI0_CH0_FLUSH_STATE5_SD1_ADDR A:0x642010c0
y.create.l HWIO_MSS_HI0_CH0_FLUSH_STATE5_SD2_ADDR A:0x642014c0
y.create.l HWIO_MSS_HI0_CH0_FLUSH_STATE5_SD3_ADDR A:0x642018c0
y.create.l HWIO_MSS_HI0_CH1_FLUSH_STATE5_SD0_ADDR A:0x64200cc4
y.create.l HWIO_MSS_HI0_CH1_FLUSH_STATE5_SD1_ADDR A:0x642010c4
y.create.l HWIO_MSS_HI0_CH1_FLUSH_STATE5_SD2_ADDR A:0x642014c4
y.create.l HWIO_MSS_HI0_CH1_FLUSH_STATE5_SD3_ADDR A:0x642018c4
y.create.l HWIO_MSS_HI0_CH2_FLUSH_STATE5_SD0_ADDR A:0x64200cc8
y.create.l HWIO_MSS_HI0_CH2_FLUSH_STATE5_SD1_ADDR A:0x642010c8
y.create.l HWIO_MSS_HI0_CH2_FLUSH_STATE5_SD2_ADDR A:0x642014c8
y.create.l HWIO_MSS_HI0_CH2_FLUSH_STATE5_SD3_ADDR A:0x642018c8
y.create.l HWIO_MSS_HI0_CH3_FLUSH_STATE5_SD0_ADDR A:0x64200ccc
y.create.l HWIO_MSS_HI0_CH3_FLUSH_STATE5_SD1_ADDR A:0x642010cc
y.create.l HWIO_MSS_HI0_CH3_FLUSH_STATE5_SD2_ADDR A:0x642014cc
y.create.l HWIO_MSS_HI0_CH3_FLUSH_STATE5_SD3_ADDR A:0x642018cc
y.create.l HWIO_MSS_HI0_CH4_FLUSH_STATE5_SD0_ADDR A:0x64200cd0
y.create.l HWIO_MSS_HI0_CH4_FLUSH_STATE5_SD1_ADDR A:0x642010d0
y.create.l HWIO_MSS_HI0_CH4_FLUSH_STATE5_SD2_ADDR A:0x642014d0
y.create.l HWIO_MSS_HI0_CH4_FLUSH_STATE5_SD3_ADDR A:0x642018d0
y.create.l HWIO_MSS_HI0_CH5_FLUSH_STATE5_SD0_ADDR A:0x64200cd4
y.create.l HWIO_MSS_HI0_CH5_FLUSH_STATE5_SD1_ADDR A:0x642010d4
y.create.l HWIO_MSS_HI0_CH5_FLUSH_STATE5_SD2_ADDR A:0x642014d4
y.create.l HWIO_MSS_HI0_CH5_FLUSH_STATE5_SD3_ADDR A:0x642018d4
y.create.l HWIO_MSS_HI0_CH6_FLUSH_STATE5_SD0_ADDR A:0x64200cd8
y.create.l HWIO_MSS_HI0_CH6_FLUSH_STATE5_SD1_ADDR A:0x642010d8
y.create.l HWIO_MSS_HI0_CH6_FLUSH_STATE5_SD2_ADDR A:0x642014d8
y.create.l HWIO_MSS_HI0_CH6_FLUSH_STATE5_SD3_ADDR A:0x642018d8
y.create.l HWIO_MSS_HI0_CH7_FLUSH_STATE5_SD0_ADDR A:0x64200cdc
y.create.l HWIO_MSS_HI0_CH7_FLUSH_STATE5_SD1_ADDR A:0x642010dc
y.create.l HWIO_MSS_HI0_CH7_FLUSH_STATE5_SD2_ADDR A:0x642014dc
y.create.l HWIO_MSS_HI0_CH7_FLUSH_STATE5_SD3_ADDR A:0x642018dc
y.create.l HWIO_MSS_HI0_SEC_DOMAIN_IRQ_STATUS_SD0_ADDR A:0x64200e80
y.create.l HWIO_MSS_HI0_SEC_DOMAIN_IRQ_STATUS_SD1_ADDR A:0x64201280
y.create.l HWIO_MSS_HI0_SEC_DOMAIN_IRQ_STATUS_SD2_ADDR A:0x64201680
y.create.l HWIO_MSS_HI0_SEC_DOMAIN_IRQ_STATUS_SD3_ADDR A:0x64201a80
y.create.l HWIO_MSS_HI0_CH0_RSLT_CONF_SD0_ADDR A:0x64200e00
y.create.l HWIO_MSS_HI0_CH0_RSLT_CONF_SD1_ADDR A:0x64201200
y.create.l HWIO_MSS_HI0_CH0_RSLT_CONF_SD2_ADDR A:0x64201600
y.create.l HWIO_MSS_HI0_CH0_RSLT_CONF_SD3_ADDR A:0x64201a00
y.create.l HWIO_MSS_HI0_CH1_RSLT_CONF_SD0_ADDR A:0x64200e04
y.create.l HWIO_MSS_HI0_CH1_RSLT_CONF_SD1_ADDR A:0x64201204
y.create.l HWIO_MSS_HI0_CH1_RSLT_CONF_SD2_ADDR A:0x64201604
y.create.l HWIO_MSS_HI0_CH1_RSLT_CONF_SD3_ADDR A:0x64201a04
y.create.l HWIO_MSS_HI0_CH2_RSLT_CONF_SD0_ADDR A:0x64200e08
y.create.l HWIO_MSS_HI0_CH2_RSLT_CONF_SD1_ADDR A:0x64201208
y.create.l HWIO_MSS_HI0_CH2_RSLT_CONF_SD2_ADDR A:0x64201608
y.create.l HWIO_MSS_HI0_CH2_RSLT_CONF_SD3_ADDR A:0x64201a08
y.create.l HWIO_MSS_HI0_CH3_RSLT_CONF_SD0_ADDR A:0x64200e0c
y.create.l HWIO_MSS_HI0_CH3_RSLT_CONF_SD1_ADDR A:0x6420120c
y.create.l HWIO_MSS_HI0_CH3_RSLT_CONF_SD2_ADDR A:0x6420160c
y.create.l HWIO_MSS_HI0_CH3_RSLT_CONF_SD3_ADDR A:0x64201a0c
y.create.l HWIO_MSS_HI0_CH4_RSLT_CONF_SD0_ADDR A:0x64200e10
y.create.l HWIO_MSS_HI0_CH4_RSLT_CONF_SD1_ADDR A:0x64201210
y.create.l HWIO_MSS_HI0_CH4_RSLT_CONF_SD2_ADDR A:0x64201610
y.create.l HWIO_MSS_HI0_CH4_RSLT_CONF_SD3_ADDR A:0x64201a10
y.create.l HWIO_MSS_HI0_CH5_RSLT_CONF_SD0_ADDR A:0x64200e14
y.create.l HWIO_MSS_HI0_CH5_RSLT_CONF_SD1_ADDR A:0x64201214
y.create.l HWIO_MSS_HI0_CH5_RSLT_CONF_SD2_ADDR A:0x64201614
y.create.l HWIO_MSS_HI0_CH5_RSLT_CONF_SD3_ADDR A:0x64201a14
y.create.l HWIO_MSS_HI0_CH6_RSLT_CONF_SD0_ADDR A:0x64200e18
y.create.l HWIO_MSS_HI0_CH6_RSLT_CONF_SD1_ADDR A:0x64201218
y.create.l HWIO_MSS_HI0_CH6_RSLT_CONF_SD2_ADDR A:0x64201618
y.create.l HWIO_MSS_HI0_CH6_RSLT_CONF_SD3_ADDR A:0x64201a18
y.create.l HWIO_MSS_HI0_CH7_RSLT_CONF_SD0_ADDR A:0x64200e1c
y.create.l HWIO_MSS_HI0_CH7_RSLT_CONF_SD1_ADDR A:0x6420121c
y.create.l HWIO_MSS_HI0_CH7_RSLT_CONF_SD2_ADDR A:0x6420161c
y.create.l HWIO_MSS_HI0_CH7_RSLT_CONF_SD3_ADDR A:0x64201a1c
y.create.l HWIO_MSS_HI0_CH0_STATUS_SD0_ADDR A:0x64200d00
y.create.l HWIO_MSS_HI0_CH0_STATUS_SD1_ADDR A:0x64201100
y.create.l HWIO_MSS_HI0_CH0_STATUS_SD2_ADDR A:0x64201500
y.create.l HWIO_MSS_HI0_CH0_STATUS_SD3_ADDR A:0x64201900
y.create.l HWIO_MSS_HI0_CH1_STATUS_SD0_ADDR A:0x64200d04
y.create.l HWIO_MSS_HI0_CH1_STATUS_SD1_ADDR A:0x64201104
y.create.l HWIO_MSS_HI0_CH1_STATUS_SD2_ADDR A:0x64201504
y.create.l HWIO_MSS_HI0_CH1_STATUS_SD3_ADDR A:0x64201904
y.create.l HWIO_MSS_HI0_CH2_STATUS_SD0_ADDR A:0x64200d08
y.create.l HWIO_MSS_HI0_CH2_STATUS_SD1_ADDR A:0x64201108
y.create.l HWIO_MSS_HI0_CH2_STATUS_SD2_ADDR A:0x64201508
y.create.l HWIO_MSS_HI0_CH2_STATUS_SD3_ADDR A:0x64201908
y.create.l HWIO_MSS_HI0_CH3_STATUS_SD0_ADDR A:0x64200d0c
y.create.l HWIO_MSS_HI0_CH3_STATUS_SD1_ADDR A:0x6420110c
y.create.l HWIO_MSS_HI0_CH3_STATUS_SD2_ADDR A:0x6420150c
y.create.l HWIO_MSS_HI0_CH3_STATUS_SD3_ADDR A:0x6420190c
y.create.l HWIO_MSS_HI0_CH4_STATUS_SD0_ADDR A:0x64200d10
y.create.l HWIO_MSS_HI0_CH4_STATUS_SD1_ADDR A:0x64201110
y.create.l HWIO_MSS_HI0_CH4_STATUS_SD2_ADDR A:0x64201510
y.create.l HWIO_MSS_HI0_CH4_STATUS_SD3_ADDR A:0x64201910
y.create.l HWIO_MSS_HI0_CH5_STATUS_SD0_ADDR A:0x64200d14
y.create.l HWIO_MSS_HI0_CH5_STATUS_SD1_ADDR A:0x64201114
y.create.l HWIO_MSS_HI0_CH5_STATUS_SD2_ADDR A:0x64201514
y.create.l HWIO_MSS_HI0_CH5_STATUS_SD3_ADDR A:0x64201914
y.create.l HWIO_MSS_HI0_CH6_STATUS_SD0_ADDR A:0x64200d18
y.create.l HWIO_MSS_HI0_CH6_STATUS_SD1_ADDR A:0x64201118
y.create.l HWIO_MSS_HI0_CH6_STATUS_SD2_ADDR A:0x64201518
y.create.l HWIO_MSS_HI0_CH6_STATUS_SD3_ADDR A:0x64201918
y.create.l HWIO_MSS_HI0_CH7_STATUS_SD0_ADDR A:0x64200d1c
y.create.l HWIO_MSS_HI0_CH7_STATUS_SD1_ADDR A:0x6420111c
y.create.l HWIO_MSS_HI0_CH7_STATUS_SD2_ADDR A:0x6420151c
y.create.l HWIO_MSS_HI0_CH7_STATUS_SD3_ADDR A:0x6420191c
y.create.l HWIO_MSS_HI0_CH0_CONF_ADDR A:0x64200d40
y.create.l HWIO_MSS_HI0_CH1_CONF_ADDR A:0x64200d44
y.create.l HWIO_MSS_HI0_CH2_CONF_ADDR A:0x64200d48
y.create.l HWIO_MSS_HI0_CH3_CONF_ADDR A:0x64200d4c
y.create.l HWIO_MSS_HI0_CH4_CONF_ADDR A:0x64200d50
y.create.l HWIO_MSS_HI0_CH5_CONF_ADDR A:0x64200d54
y.create.l HWIO_MSS_HI0_CH6_CONF_ADDR A:0x64200d58
y.create.l HWIO_MSS_HI0_CH7_CONF_ADDR A:0x64200d5c
y.create.l HWIO_MSS_HI0_CH0_DBG_0_ADDR A:0x64200d80
y.create.l HWIO_MSS_HI0_CH1_DBG_0_ADDR A:0x64200d84
y.create.l HWIO_MSS_HI0_CH2_DBG_0_ADDR A:0x64200d88
y.create.l HWIO_MSS_HI0_CH3_DBG_0_ADDR A:0x64200d8c
y.create.l HWIO_MSS_HI0_CH4_DBG_0_ADDR A:0x64200d90
y.create.l HWIO_MSS_HI0_CH5_DBG_0_ADDR A:0x64200d94
y.create.l HWIO_MSS_HI0_CH6_DBG_0_ADDR A:0x64200d98
y.create.l HWIO_MSS_HI0_CH7_DBG_0_ADDR A:0x64200d9c
y.create.l HWIO_MSS_HI0_CH0_DBG_1_ADDR A:0x64200dc0
y.create.l HWIO_MSS_HI0_CH1_DBG_1_ADDR A:0x64200dc4
y.create.l HWIO_MSS_HI0_CH2_DBG_1_ADDR A:0x64200dc8
y.create.l HWIO_MSS_HI0_CH3_DBG_1_ADDR A:0x64200dcc
y.create.l HWIO_MSS_HI0_CH4_DBG_1_ADDR A:0x64200dd0
y.create.l HWIO_MSS_HI0_CH5_DBG_1_ADDR A:0x64200dd4
y.create.l HWIO_MSS_HI0_CH6_DBG_1_ADDR A:0x64200dd8
y.create.l HWIO_MSS_HI0_CH7_DBG_1_ADDR A:0x64200ddc
y.create.l HWIO_MSS_HI0_CI0_CONF_ADDR A:0x64200e90
y.create.l HWIO_MSS_HI0_CI1_CONF_ADDR A:0x64200e94
y.create.l HWIO_MSS_HI0_CI2_CONF_ADDR A:0x64200e98
y.create.l HWIO_MSS_HI0_CI3_CONF_ADDR A:0x64200e9c
y.create.l HWIO_MSS_HI0_CI4_CONF_ADDR A:0x64200ea0
y.create.l HWIO_MSS_HI0_CI5_CONF_ADDR A:0x64200ea4
y.create.l HWIO_MSS_HI0_CI6_CONF_ADDR A:0x64200ea8
y.create.l HWIO_MSS_HI0_CI7_CONF_ADDR A:0x64200eac
y.create.l HWIO_MSS_HI0_CI0_DBG_ERR_ADDR A:0x64200eb0
y.create.l HWIO_MSS_HI0_CI1_DBG_ERR_ADDR A:0x64200eb4
y.create.l HWIO_MSS_HI0_CI2_DBG_ERR_ADDR A:0x64200eb8
y.create.l HWIO_MSS_HI0_CI3_DBG_ERR_ADDR A:0x64200ebc
y.create.l HWIO_MSS_HI0_CI4_DBG_ERR_ADDR A:0x64200ec0
y.create.l HWIO_MSS_HI0_CI5_DBG_ERR_ADDR A:0x64200ec4
y.create.l HWIO_MSS_HI0_CI6_DBG_ERR_ADDR A:0x64200ec8
y.create.l HWIO_MSS_HI0_CI7_DBG_ERR_ADDR A:0x64200ecc
y.create.l HWIO_MSS_HI0_CRCI_DBG_ADDR A:0x64200ed0
y.create.l HWIO_MSS_HI0_CRCI_STATUS_ADDR A:0x64200ed4
y.create.l HWIO_MSS_HI0_GP_CTL_ADDR A:0x64200ed8
y.create.l HWIO_MSS_HI0_GP_STATUS_ADDR A:0x64200edc
y.create.l HWIO_MSS_HI0_GLBL_DBG_CMD_ENG_ADDR A:0x64200ee0
y.create.l HWIO_MSS_HI0_GLBL_DBG_REQ_ENG_ADDR A:0x64200ee4
y.create.l HWIO_MSS_HI0_GLBL_DBG_XFR_ENG_ADDR A:0x64200ee8
y.create.l HWIO_MSS_HI0_GLBL_DBG_CHAN_BLK_ADDR A:0x64200eec
y.create.l HWIO_MSS_HI0_GLBL_DBG_CHAN_BLK_CLR_ADDR A:0x64200ef0
y.create.l HWIO_MSS_HI0_GLBL_DBG_TEST_SEL_ADDR A:0x64200ef4
y.create.l HWIO_MSS_NAV_CLK_ENABLE_ADDR A:0x642f8000
y.create.l HWIO_MSS_NAV_CLK_RESET_ADDR A:0x642f8004
y.create.l HWIO_MSS_NAV_CLK_CTL_ADDR A:0x642f8008
y.create.l HWIO_MSS_NAV_CLK_FRAC31_M_ADDR A:0x642f800c
y.create.l HWIO_MSS_NAV_CLK_FRAC31_NOT_2D_ADDR A:0x642f8010
y.create.l HWIO_MSS_NAV_CLK_FRAC31_NOT_N_MINUS_M_ADDR A:0x642f8014
y.create.l HWIO_MSS_NAV_CLK_FRAC31_UPDATE_ADDR A:0x642f8018
y.create.l HWIO_MSS_NAV_CLK_GDS_ADDR A:0x642f801c
y.create.l HWIO_MSS_NAV_CLK_IPCAT_ADDR A:0x642f8020
y.create.l HWIO_MSS_NAV_CLK_AXI_BRIDGE_STATUS_ADDR A:0x642f8024
y.create.l HWIO_MSS_GNSS_ADC_CMD0_ADDR A:0x642f0000
y.create.l HWIO_MSS_GNSS_ADC_CMD1_ADDR A:0x642f0004
y.create.l HWIO_MSS_GNSS_ADC_CMD2_ADDR A:0x642f0008
y.create.l HWIO_MSS_GNSS_ADC_CMD3_ADDR A:0x642f000c
y.create.l HWIO_MSS_GNSS_ADC_IDDQ_ADDR A:0x642f0010
y.create.l HWIO_MSS_NAV_PLL4_PLLMODE_ADDR A:0x642f8800
y.create.l HWIO_MSS_NAV_PLL4_L_VAL_ADDR A:0x642f8804
y.create.l HWIO_MSS_NAV_PLL4_ALPHA_VAL_L_ADDR A:0x642f8808
y.create.l HWIO_MSS_NAV_PLL4_ALPHA_VAL_H_ADDR A:0x642f880c
y.create.l HWIO_MSS_NAV_PLL4_USER_CTL_ADDR A:0x642f8810
y.create.l HWIO_MSS_NAV_PLL4_USER_CTL_H_ADDR A:0x642f8814
y.create.l HWIO_MSS_NAV_PLL4_CONFIG_CTL_ADDR A:0x642f8818
y.create.l HWIO_MSS_NAV_PLL4_TEST_CTL_ADDR A:0x642f881c
y.create.l HWIO_MSS_NAV_PLL4_STATUS_ADDR A:0x642f8824
y.create.l HWIO_MSS_NAV_PLL4_TEST_BUS_ADDR A:0x642f883c
y.create.l HWIO_MSS_STMR_STATUS0_RD_ADDR A:0x642000c0
y.create.l HWIO_MSS_STMR_STATUS1_RD_ADDR A:0x642000c4
y.create.l HWIO_MSS_STMR_STATUS2_RD_ADDR A:0x642000c8
y.create.l HWIO_MSS_STMR_STATUS3_RD_ADDR A:0x642000cc
y.create.l HWIO_MSS_STMR_STATUS4_RD_ADDR A:0x642000d0
y.create.l HWIO_MSS_STMR_STATUS5_RD_ADDR A:0x642000d4
y.create.l HWIO_MSS_STMR_STATUS6_RD_ADDR A:0x642000d8
y.create.l HWIO_MSS_STMR_STATUS7_RD_ADDR A:0x642000dc
y.create.l HWIO_MSS_STMR_STATUS8_RD_ADDR A:0x642000e0
y.create.l HWIO_MSS_STMR_STATUS9_RD_ADDR A:0x642000e4
y.create.l HWIO_MSS_STMR_STATUS10_RD_ADDR A:0x642000e8
y.create.l HWIO_MSS_STMR_STATUS11_RD_ADDR A:0x642000ec
y.create.l HWIO_VUSS1_VUSS_ENABLE_ADDR A:0x65020000
y.create.l HWIO_VUSS1_VUSS_CLK_CTL_ADDR A:0x65020004
y.create.l HWIO_VUSS1_VUSS_CLK_EN_ADDR A:0x65020008
y.create.l HWIO_VUSS1_VUSS_PWR_SEQ_EN_ADDR A:0x6502000c
y.create.l HWIO_VUSS1_VUSS_MODE_CTL_ADDR A:0x65020010
y.create.l HWIO_VUSS1_VUSS_PWR_STATUS_ADDR A:0x65020014
y.create.l HWIO_VUSS1_VUSS_IRQ_PEND_WDATA_ADDR A:0x65020020
y.create.l HWIO_VUSS1_VUSS_IRQ_PEND_RDATA_ADDR A:0x65020024
y.create.l HWIO_VUSS1_VUSS_DBG_EN_ADDR A:0x65020030
y.create.l HWIO_VUSS1_VUSS_DBG_PCTRACE_CTL_ADDR A:0x65020034
y.create.l HWIO_VUSS1_VUSS_DBG_PCTRACE_BUF_STAT_ADDR A:0x65020038
y.create.l HWIO_VUSS1_VUSS_DBG_PCTRACE_BUF_CURRENT_ADDR A:0x6502003c
y.create.l HWIO_VUSS1_VUSS_DBG_PCTRACE_BUF_TARGET_ADDR A:0x65020040
y.create.l HWIO_VUSS1_PMEMSS_ENABLE_ADDR A:0x65020800
y.create.l HWIO_VUSS1_PMEMSS_CTRL_ADDR A:0x65020804
y.create.l HWIO_VUSS1_PMEMSS_DDR_ADDR_ADDR A:0x65020808
y.create.l HWIO_VUSS1_PMEMSS_REMAP_PC0_ADDR A:0x65020810
y.create.l HWIO_VUSS1_PMEMSS_REMAP_LMEM0_ADDR A:0x65020814
y.create.l HWIO_VUSS1_PMEMSS_REMAP_PC1_ADDR A:0x65020818
y.create.l HWIO_VUSS1_PMEMSS_REMAP_LMEM1_ADDR A:0x6502081c
y.create.l HWIO_VUSS1_PMEMSS_REMAP_PC2_ADDR A:0x65020820
y.create.l HWIO_VUSS1_PMEMSS_REMAP_LMEM2_ADDR A:0x65020824
y.create.l HWIO_VUSS1_PMEMSS_MODE_SWITCH_ADDR A:0x65020828
y.create.l HWIO_VUSS1_PMEMSS_DBG_RD_ADDR_ADDR A:0x65020830
y.create.l HWIO_VUSS1_PMEMSS_DBG_RD_DATA_ADDR A:0x65020834
y.create.l HWIO_VUSS1_PMEMSS_DBG_WR_ADDR_ADDR A:0x65020840
y.create.l HWIO_VUSS1_PMEMSS_DBG_WR_DATA0_ADDR A:0x65020850
y.create.l HWIO_VUSS1_PMEMSS_DBG_WR_DATA1_ADDR A:0x65020854
y.create.l HWIO_VUSS1_PMEMSS_DBG_WR_DATA2_ADDR A:0x65020858
y.create.l HWIO_VUSS1_PMEMSS_DBG_WR_DATA3_ADDR A:0x6502085c
y.create.l HWIO_VUSS1_VUSS_DMEM_X4X8_START_ADDR A:0x65021000
y.create.l HWIO_VUSS1_VUSS_DMEM_X4X8_END_ADDR A:0x65024ffc
y.create.l HWIO_VUSS2_VUSS_ENABLE_ADDR A:0x65040000
y.create.l HWIO_VUSS2_VUSS_CLK_CTL_ADDR A:0x65040004
y.create.l HWIO_VUSS2_VUSS_CLK_EN_ADDR A:0x65040008
y.create.l HWIO_VUSS2_VUSS_PWR_SEQ_EN_ADDR A:0x6504000c
y.create.l HWIO_VUSS2_VUSS_MODE_CTL_ADDR A:0x65040010
y.create.l HWIO_VUSS2_VUSS_PWR_STATUS_ADDR A:0x65040014
y.create.l HWIO_VUSS2_VUSS_IRQ_PEND_WDATA_ADDR A:0x65040020
y.create.l HWIO_VUSS2_VUSS_IRQ_PEND_RDATA_ADDR A:0x65040024
y.create.l HWIO_VUSS2_VUSS_DBG_EN_ADDR A:0x65040030
y.create.l HWIO_VUSS2_VUSS_DBG_PCTRACE_CTL_ADDR A:0x65040034
y.create.l HWIO_VUSS2_VUSS_DBG_PCTRACE_BUF_STAT_ADDR A:0x65040038
y.create.l HWIO_VUSS2_VUSS_DBG_PCTRACE_BUF_CURRENT_ADDR A:0x6504003c
y.create.l HWIO_VUSS2_VUSS_DBG_PCTRACE_BUF_TARGET_ADDR A:0x65040040
y.create.l HWIO_VUSS2_VUSS_DMEM_X4X8_START_ADDR A:0x65041000
y.create.l HWIO_VUSS2_VUSS_DMEM_X4X8_END_ADDR A:0x65044ffc
y.create.l HWIO_VUSS3_VUSS_ENABLE_ADDR A:0x65060000
y.create.l HWIO_VUSS3_VUSS_CLK_CTL_ADDR A:0x65060004
y.create.l HWIO_VUSS3_VUSS_CLK_EN_ADDR A:0x65060008
y.create.l HWIO_VUSS3_VUSS_PWR_SEQ_EN_ADDR A:0x6506000c
y.create.l HWIO_VUSS3_VUSS_MODE_CTL_ADDR A:0x65060010
y.create.l HWIO_VUSS3_VUSS_PWR_STATUS_ADDR A:0x65060014
y.create.l HWIO_VUSS3_VUSS_IRQ_PEND_WDATA_ADDR A:0x65060020
y.create.l HWIO_VUSS3_VUSS_IRQ_PEND_RDATA_ADDR A:0x65060024
y.create.l HWIO_VUSS3_VUSS_DBG_EN_ADDR A:0x65060030
y.create.l HWIO_VUSS3_VUSS_DBG_PCTRACE_CTL_ADDR A:0x65060034
y.create.l HWIO_VUSS3_VUSS_DBG_PCTRACE_BUF_STAT_ADDR A:0x65060038
y.create.l HWIO_VUSS3_VUSS_DBG_PCTRACE_BUF_CURRENT_ADDR A:0x6506003c
y.create.l HWIO_VUSS3_VUSS_DBG_PCTRACE_BUF_TARGET_ADDR A:0x65060040
y.create.l HWIO_VUSS3_VUSS_DMEM_X4X8_START_ADDR A:0x65061000
y.create.l HWIO_VUSS3_VUSS_DMEM_X4X8_END_ADDR A:0x65064ffc
y.create.l HWIO_VUSS4_VUSS_ENABLE_ADDR A:0x65080000
y.create.l HWIO_VUSS4_VUSS_CLK_CTL_ADDR A:0x65080004
y.create.l HWIO_VUSS4_VUSS_CLK_EN_ADDR A:0x65080008
y.create.l HWIO_VUSS4_VUSS_PWR_SEQ_EN_ADDR A:0x6508000c
y.create.l HWIO_VUSS4_VUSS_MODE_CTL_ADDR A:0x65080010
y.create.l HWIO_VUSS4_VUSS_PWR_STATUS_ADDR A:0x65080014
y.create.l HWIO_VUSS4_VUSS_IRQ_PEND_WDATA_ADDR A:0x65080020
y.create.l HWIO_VUSS4_VUSS_IRQ_PEND_RDATA_ADDR A:0x65080024
y.create.l HWIO_VUSS4_VUSS_DBG_EN_ADDR A:0x65080030
y.create.l HWIO_VUSS4_VUSS_DBG_PCTRACE_CTL_ADDR A:0x65080034
y.create.l HWIO_VUSS4_VUSS_DBG_PCTRACE_BUF_STAT_ADDR A:0x65080038
y.create.l HWIO_VUSS4_VUSS_DBG_PCTRACE_BUF_CURRENT_ADDR A:0x6508003c
y.create.l HWIO_VUSS4_VUSS_DBG_PCTRACE_BUF_TARGET_ADDR A:0x65080040
y.create.l HWIO_VUSS4_PMEMSS_ENABLE_ADDR A:0x65080800
y.create.l HWIO_VUSS4_PMEMSS_CTRL_ADDR A:0x65080804
y.create.l HWIO_VUSS4_PMEMSS_DDR_ADDR_ADDR A:0x65080808
y.create.l HWIO_VUSS4_PMEMSS_REMAP_PC0_ADDR A:0x65080810
y.create.l HWIO_VUSS4_PMEMSS_REMAP_LMEM0_ADDR A:0x65080814
y.create.l HWIO_VUSS4_PMEMSS_REMAP_PC1_ADDR A:0x65080818
y.create.l HWIO_VUSS4_PMEMSS_REMAP_LMEM1_ADDR A:0x6508081c
y.create.l HWIO_VUSS4_PMEMSS_REMAP_PC2_ADDR A:0x65080820
y.create.l HWIO_VUSS4_PMEMSS_REMAP_LMEM2_ADDR A:0x65080824
y.create.l HWIO_VUSS4_PMEMSS_MODE_SWITCH_ADDR A:0x65080828
y.create.l HWIO_VUSS4_PMEMSS_DBG_RD_ADDR_ADDR A:0x65080830
y.create.l HWIO_VUSS4_PMEMSS_DBG_RD_DATA_ADDR A:0x65080834
y.create.l HWIO_VUSS4_PMEMSS_DBG_WR_ADDR_ADDR A:0x65080840
y.create.l HWIO_VUSS4_PMEMSS_DBG_WR_DATA0_ADDR A:0x65080850
y.create.l HWIO_VUSS4_PMEMSS_DBG_WR_DATA1_ADDR A:0x65080854
y.create.l HWIO_VUSS4_PMEMSS_DBG_WR_DATA2_ADDR A:0x65080858
y.create.l HWIO_VUSS4_PMEMSS_DBG_WR_DATA3_ADDR A:0x6508085c
y.create.l HWIO_VUSS4_VUSS_DMEM_X4X8_START_ADDR A:0x65081000
y.create.l HWIO_VUSS4_VUSS_DMEM_X4X8_END_ADDR A:0x65084ffc
y.create.l HWIO_VUSS5_VUSS_ENABLE_ADDR A:0x650a0000
y.create.l HWIO_VUSS5_VUSS_CLK_CTL_ADDR A:0x650a0004
y.create.l HWIO_VUSS5_VUSS_CLK_EN_ADDR A:0x650a0008
y.create.l HWIO_VUSS5_VUSS_PWR_SEQ_EN_ADDR A:0x650a000c
y.create.l HWIO_VUSS5_VUSS_MODE_CTL_ADDR A:0x650a0010
y.create.l HWIO_VUSS5_VUSS_PWR_STATUS_ADDR A:0x650a0014
y.create.l HWIO_VUSS5_VUSS_IRQ_PEND_WDATA_ADDR A:0x650a0020
y.create.l HWIO_VUSS5_VUSS_IRQ_PEND_RDATA_ADDR A:0x650a0024
y.create.l HWIO_VUSS5_VUSS_DBG_EN_ADDR A:0x650a0030
y.create.l HWIO_VUSS5_VUSS_DBG_PCTRACE_CTL_ADDR A:0x650a0034
y.create.l HWIO_VUSS5_VUSS_DBG_PCTRACE_BUF_STAT_ADDR A:0x650a0038
y.create.l HWIO_VUSS5_VUSS_DBG_PCTRACE_BUF_CURRENT_ADDR A:0x650a003c
y.create.l HWIO_VUSS5_VUSS_DBG_PCTRACE_BUF_TARGET_ADDR A:0x650a0040
y.create.l HWIO_VUSS5_VUSS_DMEM_X4X8_START_ADDR A:0x650a1000
y.create.l HWIO_VUSS5_VUSS_DMEM_X4X8_END_ADDR A:0x650a4ffc
y.create.l HWIO_VUSS6_VUSS_ENABLE_ADDR A:0x650c0000
y.create.l HWIO_VUSS6_VUSS_CLK_CTL_ADDR A:0x650c0004
y.create.l HWIO_VUSS6_VUSS_CLK_EN_ADDR A:0x650c0008
y.create.l HWIO_VUSS6_VUSS_PWR_SEQ_EN_ADDR A:0x650c000c
y.create.l HWIO_VUSS6_VUSS_MODE_CTL_ADDR A:0x650c0010
y.create.l HWIO_VUSS6_VUSS_PWR_STATUS_ADDR A:0x650c0014
y.create.l HWIO_VUSS6_VUSS_IRQ_PEND_WDATA_ADDR A:0x650c0020
y.create.l HWIO_VUSS6_VUSS_IRQ_PEND_RDATA_ADDR A:0x650c0024
y.create.l HWIO_VUSS6_VUSS_DBG_EN_ADDR A:0x650c0030
y.create.l HWIO_VUSS6_VUSS_DBG_PCTRACE_CTL_ADDR A:0x650c0034
y.create.l HWIO_VUSS6_VUSS_DBG_PCTRACE_BUF_STAT_ADDR A:0x650c0038
y.create.l HWIO_VUSS6_VUSS_DBG_PCTRACE_BUF_CURRENT_ADDR A:0x650c003c
y.create.l HWIO_VUSS6_VUSS_DBG_PCTRACE_BUF_TARGET_ADDR A:0x650c0040
y.create.l HWIO_VUSS6_PMEMSS_ENABLE_ADDR A:0x650c0800
y.create.l HWIO_VUSS6_PMEMSS_CTRL_ADDR A:0x650c0804
y.create.l HWIO_VUSS6_PMEMSS_DDR_ADDR_ADDR A:0x650c0808
y.create.l HWIO_VUSS6_PMEMSS_REMAP_PC0_ADDR A:0x650c0810
y.create.l HWIO_VUSS6_PMEMSS_REMAP_LMEM0_ADDR A:0x650c0814
y.create.l HWIO_VUSS6_PMEMSS_REMAP_PC1_ADDR A:0x650c0818
y.create.l HWIO_VUSS6_PMEMSS_REMAP_LMEM1_ADDR A:0x650c081c
y.create.l HWIO_VUSS6_PMEMSS_REMAP_PC2_ADDR A:0x650c0820
y.create.l HWIO_VUSS6_PMEMSS_REMAP_LMEM2_ADDR A:0x650c0824
y.create.l HWIO_VUSS6_PMEMSS_MODE_SWITCH_ADDR A:0x650c0828
y.create.l HWIO_VUSS6_PMEMSS_DBG_RD_ADDR_ADDR A:0x650c0830
y.create.l HWIO_VUSS6_PMEMSS_DBG_RD_DATA_ADDR A:0x650c0834
y.create.l HWIO_VUSS6_PMEMSS_DBG_WR_ADDR_ADDR A:0x650c0840
y.create.l HWIO_VUSS6_PMEMSS_DBG_WR_DATA0_ADDR A:0x650c0850
y.create.l HWIO_VUSS6_PMEMSS_DBG_WR_DATA1_ADDR A:0x650c0854
y.create.l HWIO_VUSS6_PMEMSS_DBG_WR_DATA2_ADDR A:0x650c0858
y.create.l HWIO_VUSS6_PMEMSS_DBG_WR_DATA3_ADDR A:0x650c085c
y.create.l HWIO_VUSS6_VUSS_DMEM_X4X8_START_ADDR A:0x650c1000
y.create.l HWIO_VUSS6_VUSS_DMEM_X4X8_END_ADDR A:0x650c4ffc
y.create.l HWIO_DEMAP_VUSS_ENABLE_ADDR A:0x650e0000
y.create.l HWIO_DEMAP_VUSS_CLK_CTL_ADDR A:0x650e0004
y.create.l HWIO_DEMAP_VUSS_CLK_EN_ADDR A:0x650e0008
y.create.l HWIO_DEMAP_VUSS_PWR_SEQ_EN_ADDR A:0x650e000c
y.create.l HWIO_DEMAP_VUSS_MODE_CTL_ADDR A:0x650e0010
y.create.l HWIO_DEMAP_VUSS_PWR_STATUS_ADDR A:0x650e0014
y.create.l HWIO_DEMAP_VUSS_IRQ_PEND_WDATA_ADDR A:0x650e0020
y.create.l HWIO_DEMAP_VUSS_IRQ_PEND_RDATA_ADDR A:0x650e0024
y.create.l HWIO_DEMAP_VUSS_DBG_EN_ADDR A:0x650e0030
y.create.l HWIO_DEMAP_VUSS_DBG_PCTRACE_CTL_ADDR A:0x650e0034
y.create.l HWIO_DEMAP_VUSS_DBG_PCTRACE_BUF_STAT_ADDR A:0x650e0038
y.create.l HWIO_DEMAP_VUSS_DBG_PCTRACE_BUF_CURRENT_ADDR A:0x650e003c
y.create.l HWIO_DEMAP_VUSS_DBG_PCTRACE_BUF_TARGET_ADDR A:0x650e0040
y.create.l HWIO_DEMAP_VUSS_DMEM_X4X8_START_ADDR A:0x650e1000
y.create.l HWIO_DEMAP_VUSS_DMEM_X4X8_END_ADDR A:0x650e4ffc
y.create.l HWIO_CCHP_VUSS_ENABLE_ADDR A:0x65100000
y.create.l HWIO_CCHP_VUSS_CLK_CTL_ADDR A:0x65100004
y.create.l HWIO_CCHP_VUSS_CLK_EN_ADDR A:0x65100008
y.create.l HWIO_CCHP_VUSS_PWR_SEQ_EN_ADDR A:0x6510000c
y.create.l HWIO_CCHP_VUSS_MODE_CTL_ADDR A:0x65100010
y.create.l HWIO_CCHP_VUSS_PWR_STATUS_ADDR A:0x65100014
y.create.l HWIO_CCHP_VUSS_IRQ_PEND_WDATA_ADDR A:0x65100020
y.create.l HWIO_CCHP_VUSS_IRQ_PEND_RDATA_ADDR A:0x65100024
y.create.l HWIO_CCHP_VUSS_DBG_EN_ADDR A:0x65100030
y.create.l HWIO_CCHP_VUSS_DBG_PCTRACE_CTL_ADDR A:0x65100034
y.create.l HWIO_CCHP_VUSS_DBG_PCTRACE_BUF_STAT_ADDR A:0x65100038
y.create.l HWIO_CCHP_VUSS_DBG_PCTRACE_BUF_CURRENT_ADDR A:0x6510003c
y.create.l HWIO_CCHP_VUSS_DBG_PCTRACE_BUF_TARGET_ADDR A:0x65100040
y.create.l HWIO_CCHP_PMEMSS_ENABLE_ADDR A:0x65100800
y.create.l HWIO_CCHP_PMEMSS_CTRL_ADDR A:0x65100804
y.create.l HWIO_CCHP_PMEMSS_DDR_ADDR_ADDR A:0x65100808
y.create.l HWIO_CCHP_PMEMSS_REMAP_PC0_ADDR A:0x65100810
y.create.l HWIO_CCHP_PMEMSS_REMAP_LMEM0_ADDR A:0x65100814
y.create.l HWIO_CCHP_PMEMSS_REMAP_PC1_ADDR A:0x65100818
y.create.l HWIO_CCHP_PMEMSS_REMAP_LMEM1_ADDR A:0x6510081c
y.create.l HWIO_CCHP_PMEMSS_REMAP_PC2_ADDR A:0x65100820
y.create.l HWIO_CCHP_PMEMSS_REMAP_LMEM2_ADDR A:0x65100824
y.create.l HWIO_CCHP_PMEMSS_MODE_SWITCH_ADDR A:0x65100828
y.create.l HWIO_CCHP_PMEMSS_DBG_RD_ADDR_ADDR A:0x65100830
y.create.l HWIO_CCHP_PMEMSS_DBG_RD_DATA_ADDR A:0x65100834
y.create.l HWIO_CCHP_PMEMSS_DBG_WR_ADDR_ADDR A:0x65100840
y.create.l HWIO_CCHP_PMEMSS_DBG_WR_DATA0_ADDR A:0x65100850
y.create.l HWIO_CCHP_PMEMSS_DBG_WR_DATA1_ADDR A:0x65100854
y.create.l HWIO_CCHP_PMEMSS_DBG_WR_DATA2_ADDR A:0x65100858
y.create.l HWIO_CCHP_PMEMSS_DBG_WR_DATA3_ADDR A:0x6510085c
y.create.l HWIO_CCHP_VUSS_DMEM_CCHP_START_ADDR A:0x65101000
y.create.l HWIO_CCHP_VUSS_DMEM_CCHP_END_ADDR A:0x65108ffc
y.create.l HWIO_ENC_VUSS_ENABLE_ADDR A:0x65120000
y.create.l HWIO_ENC_VUSS_CLK_CTL_ADDR A:0x65120004
y.create.l HWIO_ENC_VUSS_CLK_EN_ADDR A:0x65120008
y.create.l HWIO_ENC_VUSS_PWR_SEQ_EN_ADDR A:0x6512000c
y.create.l HWIO_ENC_VUSS_MODE_CTL_ADDR A:0x65120010
y.create.l HWIO_ENC_VUSS_PWR_STATUS_ADDR A:0x65120014
y.create.l HWIO_ENC_VUSS_IRQ_PEND_WDATA_ADDR A:0x65120020
y.create.l HWIO_ENC_VUSS_IRQ_PEND_RDATA_ADDR A:0x65120024
y.create.l HWIO_ENC_VUSS_DBG_EN_ADDR A:0x65120030
y.create.l HWIO_ENC_VUSS_DBG_PCTRACE_CTL_ADDR A:0x65120034
y.create.l HWIO_ENC_VUSS_DBG_PCTRACE_BUF_STAT_ADDR A:0x65120038
y.create.l HWIO_ENC_VUSS_DBG_PCTRACE_BUF_CURRENT_ADDR A:0x6512003c
y.create.l HWIO_ENC_VUSS_DBG_PCTRACE_BUF_TARGET_ADDR A:0x65120040
y.create.l HWIO_ENC_VUSS_DMEM_ENC_START_ADDR A:0x65121000
y.create.l HWIO_ENC_VUSS_DMEM_ENC_END_ADDR A:0x6512e7fc
y.create.l HWIO_MPMU_ENABLE_ADDR A:0x65300400
y.create.l HWIO_OFFLINE_ENABLE_ADDR A:0x65300410
y.create.l HWIO_MPMU_PWR_GATING_STATUS_ADDR A:0x65300420
y.create.l HWIO_MPMU_IRQ2L_EN_ADDR A:0x65300440
y.create.l HWIO_MPMU_IRQ2L_PEND_CLR_ADDR A:0x65300444
y.create.l HWIO_MPMU_IRQ2L_PEND_SET_ADDR A:0x65300448
y.create.l HWIO_MPMU_IRQ2L_PEND_STAT_ADDR A:0x6530044c
y.create.l HWIO_MPMU_STMR_MON0_ADDR A:0x65300450
y.create.l HWIO_MPMU_STMR_MON1_ADDR A:0x65300458
y.create.l HWIO_MPMU_EVT_TRIGGER_ADDR A:0x65300460
y.create.l HWIO_CLK_PROC_ODIV_ADDR A:0x65300480
y.create.l HWIO_CLK_TDEC_ODIV_ADDR A:0x65300484
y.create.l HWIO_MPMU_PWRMODE_CTL_ADDR A:0x65300494
y.create.l HWIO_MPMU_PWRMODE_STAT_ADDR A:0x65300498
y.create.l HWIO_MPMU_VOLTAGE_CHANGE_ADDR A:0x653004a0
y.create.l HWIO_MPMU_VU0_PWR_LVL_ADDR A:0x65300500
y.create.l HWIO_MPMU_VU1_PWR_LVL_ADDR A:0x65300504
y.create.l HWIO_MPMU_VU2_PWR_LVL_ADDR A:0x65300508
y.create.l HWIO_MPMU_VU3_PWR_LVL_ADDR A:0x6530050c
y.create.l HWIO_MPMU_VU4_PWR_LVL_ADDR A:0x65300510
y.create.l HWIO_MPMU_VU5_PWR_LVL_ADDR A:0x65300514
y.create.l HWIO_MPMU_VU6_PWR_LVL_ADDR A:0x65300518
y.create.l HWIO_MPMU_VU7_PWR_LVL_ADDR A:0x6530051c
y.create.l HWIO_MPMU_VU8_PWR_LVL_ADDR A:0x65300520
y.create.l HWIO_MPMU_VU9_PWR_LVL_ADDR A:0x65300524
y.create.l HWIO_DTR_MP_SLOT_REQ_ADDR A:0x65300600
y.create.l HWIO_MEM_CLUSTER_EN_ADDR A:0x65300610
y.create.l HWIO_MEM_CLUSTER_PWRUP_ADDR A:0x65300614
y.create.l HWIO_MEM_CLUSTER_PWR_STAT_ADDR A:0x65300618
y.create.l HWIO_MNOCBR_CTRL_REG_ADDR A:0x65400000
y.create.l HWIO_MNOCBR_WR_ERROR_REG_ADDR A:0x65400004
y.create.l HWIO_MNOCBR_RD_ERROR_REG_ADDR A:0x65400008
y.create.l HWIO_MNOCBR_WR_BASE_OFFSET_0_ADDR A:0x65400040
y.create.l HWIO_MNOCBR_WR_BASE_OFFSET_1_ADDR A:0x65400044
y.create.l HWIO_MNOCBR_WR_BASE_OFFSET_2_ADDR A:0x65400048
y.create.l HWIO_MNOCBR_WR_BASE_OFFSET_3_ADDR A:0x6540004c
y.create.l HWIO_MNOCBR_WR_BASE_OFFSET_4_ADDR A:0x65400050
y.create.l HWIO_MNOCBR_WR_BASE_OFFSET_5_ADDR A:0x65400054
y.create.l HWIO_MNOCBR_WR_BASE_OFFSET_6_ADDR A:0x65400058
y.create.l HWIO_MNOCBR_WR_BASE_OFFSET_7_ADDR A:0x6540005c
y.create.l HWIO_MNOCBR_WR_BASE_OFFSET_8_ADDR A:0x65400060
y.create.l HWIO_MNOCBR_WR_BASE_OFFSET_9_ADDR A:0x65400064
y.create.l HWIO_MNOCBR_RD_BASE_OFFSET_0_ADDR A:0x65400080
y.create.l HWIO_MNOCBR_RD_BASE_OFFSET_1_ADDR A:0x65400084
y.create.l HWIO_MNOCBR_RD_BASE_OFFSET_2_ADDR A:0x65400088
y.create.l HWIO_MNOCBR_RD_BASE_OFFSET_3_ADDR A:0x6540008c
y.create.l HWIO_MNOCBR_RD_BASE_OFFSET_4_ADDR A:0x65400090
y.create.l HWIO_MNOCBR_RD_BASE_OFFSET_5_ADDR A:0x65400094
y.create.l HWIO_MNOCBR_RD_BASE_OFFSET_6_ADDR A:0x65400098
y.create.l HWIO_MNOCBR_RD_BASE_OFFSET_7_ADDR A:0x6540009c
y.create.l HWIO_MNOCBR_RD_BASE_OFFSET_8_ADDR A:0x654000a0
y.create.l HWIO_MNOCBR_RD_BASE_OFFSET_9_ADDR A:0x654000a4
y.create.l HWIO_CIPHER_CK_WORD0_ADDR A:0x6561fe00
y.create.l HWIO_CIPHER_CK_WORD1_ADDR A:0x6561fe04
y.create.l HWIO_CIPHER_CK_WORD2_ADDR A:0x6561fe08
y.create.l HWIO_CIPHER_CK_WORD3_ADDR A:0x6561fe0c
y.create.l HWIO_CIPHER_INIT_WORD0_ADDR A:0x6561fe10
y.create.l HWIO_CIPHER_INIT_WORD1_ADDR A:0x6561fe14
y.create.l HWIO_CIPHER_SETUP_WORD0_ADDR A:0x6561fe18
y.create.l HWIO_CIPHER_SETUP_WORD1_ADDR A:0x6561fe1c
y.create.l HWIO_CIPHER_DMA_CFG0_ADDR A:0x6561fe20
y.create.l HWIO_CIPHER_DMA_CFG1_ADDR A:0x6561fe24
y.create.l HWIO_CIPHER_DMA_CFG2_ADDR A:0x6561fe28
y.create.l HWIO_CIPHER_RMW_WORD_ADDR A:0x6561fe2c
y.create.l HWIO_CIPHER_CMD_CTRL_ADDR A:0x6561fe30
y.create.l HWIO_CIPHER_TRIGGER_ADDR A:0x6561fe34
y.create.l HWIO_CIPHER_DEBUG_EN_ADDR A:0x6561fe38
y.create.l HWIO_CIPHER_KS_VECTOR_WORD0_ADDR A:0x6561fe3c
y.create.l HWIO_CIPHER_KS_VECTOR_WORD1_ADDR A:0x6561fe40
y.create.l HWIO_CIPHER_KS_VECTOR_WORD2_ADDR A:0x6561fe44
y.create.l HWIO_CIPHER_KS_VECTOR_WORD3_ADDR A:0x6561fe48
y.create.l HWIO_ENCRYPT_ACC_RESET_ADDR A:0x6561ff00
y.create.l HWIO_ENCRYPT_ACC_CGC_CTL_ADDR A:0x6561ff04
y.create.l HWIO_ENCRYPT_ACC_CGC_STATUS_ADDR A:0x6561ff08
y.create.l HWIO_GEA_CONFIG_0_ADDR A:0x6561ff0c
y.create.l HWIO_GEA_INPUT_ADDR A:0x6561ff10
y.create.l HWIO_GEA_KC_0_ADDR A:0x6561ff14
y.create.l HWIO_GEA_KC_1_ADDR A:0x6561ff18
y.create.l HWIO_AMBA_KEY_STRM_WORD0_RD_ADDR A:0x6561ff1c
y.create.l HWIO_AMBA_KEY_STRM_WORD1_RD_ADDR A:0x6561ff20
y.create.l HWIO_AMBA_KEY_STRM_WORD2_RD_ADDR A:0x6561ff24
y.create.l HWIO_AMBA_KEY_STRM_WORD3_RD_ADDR A:0x6561ff28
y.create.l HWIO_AMBA_KEY_STRM_WORD4_RD_ADDR A:0x6561ff2c
y.create.l HWIO_AMBA_KEY_STRM_WORD5_RD_ADDR A:0x6561ff30
y.create.l HWIO_AMBA_KEY_STRM_WORD6_RD_ADDR A:0x6561ff34
y.create.l HWIO_AMBA_KEY_STRM_WORD7_RD_ADDR A:0x6561ff38
y.create.l HWIO_AMBA_KEY_STRM_STATUS_ADDR A:0x6561ff3c
y.create.l HWIO_AFIVE_CONFIG_0_ADDR A:0x6561ff40
y.create.l HWIO_AFIVE_INPUT_ADDR A:0x6561ff44
y.create.l HWIO_AFIVE_KC_0_ADDR A:0x6561ff48
y.create.l HWIO_AFIVE_KC_1_ADDR A:0x6561ff4c
y.create.l HWIO_AFIVE_KEY_STRM_WORD0_RD_ADDR A:0x6561ff50
y.create.l HWIO_AFIVE_KEY_STRM_WORD1_RD_ADDR A:0x6561ff54
y.create.l HWIO_AFIVE_KEY_STRM_WORD2_RD_ADDR A:0x6561ff58
y.create.l HWIO_AFIVE_KEY_STRM_WORD3_RD_ADDR A:0x6561ff5c
y.create.l HWIO_AFIVE_KEY_STRM_WORD4_RD_ADDR A:0x6561ff60
y.create.l HWIO_AFIVE_KEY_STRM_WORD5_RD_ADDR A:0x6561ff64
y.create.l HWIO_AFIVE_KEY_STRM_WORD6_RD_ADDR A:0x6561ff68
y.create.l HWIO_AFIVE_KEY_STRM_WORD7_RD_ADDR A:0x6561ff6c
y.create.l HWIO_AFIVE_KEY_STRM_WORD8_RD_ADDR A:0x6561ff70
y.create.l HWIO_AFIVE_KEY_STRM_WORD9_RD_ADDR A:0x6561ff74
y.create.l HWIO_CCS_MSTS_ADDR A:0x6561fc00
y.create.l HWIO_CCS_MCTL_ADDR A:0x6561fc04
y.create.l HWIO_CCS_IPC_ADDR A:0x6561fc08
y.create.l HWIO_CCS_PIC0MSK_ADDR A:0x6561fc0c
y.create.l HWIO_CCS_PIC0STS_ADDR A:0x6561fc10
y.create.l HWIO_CCS_PIC1MSK_ADDR A:0x6561fc14
y.create.l HWIO_CCS_PIC1STS_ADDR A:0x6561fc18
y.create.l HWIO_CCS_PIC2MSK_ADDR A:0x6561fc1c
y.create.l HWIO_CCS_PIC2STS_ADDR A:0x6561fc20
y.create.l HWIO_CCS_PIC3MSK_ADDR A:0x6561fc24
y.create.l HWIO_CCS_PIC3STS_ADDR A:0x6561fc28
y.create.l HWIO_CCS_PIC4MSK_ADDR A:0x6561fc2c
y.create.l HWIO_CCS_PIC4STS_ADDR A:0x6561fc30
y.create.l HWIO_CCS_PIT_ADDR A:0x6561fc34
y.create.l HWIO_CCS_UTIME_ADDR A:0x6561fc38
y.create.l HWIO_CCS_MON0_ADDR A:0x6561fc3c
y.create.l HWIO_CCS_MON1_ADDR A:0x6561fc40
y.create.l HWIO_CCS_MON2_ADDR A:0x6561fc44
y.create.l HWIO_CCS_MON3_ADDR A:0x6561fc48
y.create.l HWIO_CCS_DMAC_ADDR A:0x6561fc4c
y.create.l HWIO_CCS_DMAC0SRC_ADDR A:0x6561fc50
y.create.l HWIO_CCS_DMAC1SRC_ADDR A:0x6561fc60
y.create.l HWIO_CCS_DMAC2SRC_ADDR A:0x6561fc70
y.create.l HWIO_CCS_DMAC3SRC_ADDR A:0x6561fc80
y.create.l HWIO_CCS_DMAC0DST_ADDR A:0x6561fc54
y.create.l HWIO_CCS_DMAC1DST_ADDR A:0x6561fc64
y.create.l HWIO_CCS_DMAC2DST_ADDR A:0x6561fc74
y.create.l HWIO_CCS_DMAC3DST_ADDR A:0x6561fc84
y.create.l HWIO_CCS_DMAC0LNK_ADDR A:0x6561fc58
y.create.l HWIO_CCS_DMAC1LNK_ADDR A:0x6561fc68
y.create.l HWIO_CCS_DMAC2LNK_ADDR A:0x6561fc78
y.create.l HWIO_CCS_DMAC3LNK_ADDR A:0x6561fc88
y.create.l HWIO_CCS_DMAC0CTL_ADDR A:0x6561fc5c
y.create.l HWIO_CCS_DMAC1CTL_ADDR A:0x6561fc6c
y.create.l HWIO_CCS_DMAC2CTL_ADDR A:0x6561fc7c
y.create.l HWIO_CCS_DMAC3CTL_ADDR A:0x6561fc8c
y.create.l HWIO_CCS_DEMBACK_PWRUP_ADDR A:0x6561fc90
y.create.l HWIO_CCS_DEMBACK_PWRON_ADDR A:0x6561fc94
y.create.l HWIO_CCS_PIC0MRG_ADDR A:0x6561fc98
y.create.l HWIO_CCS_PIC2MRG_ADDR A:0x6561fc9c
y.create.l HWIO_CCS_CLUSTER_SEL_ADDR A:0x6561fca0
y.create.l HWIO_CPMEM_MIN_ADDR A:0x6561f800
y.create.l HWIO_CPMEM_MAX_ADDR A:0x6561fbfc
y.create.l HWIO_PDMEM_MIN_ADDR A:0x65600000
y.create.l HWIO_PDMEM_MAX_ADDR A:0x6560fffc
y.create.l HWIO_MCDMA_RESET_ADDR A:0x65620400
y.create.l HWIO_MCDMA_ENABLE_ADDR A:0x65620404
y.create.l HWIO_MCDMA_LOG_CH_BUSY_ADDR A:0x65620408
y.create.l HWIO_MCDMA_LOG_HW_CH0_SYNC_ADDR A:0x6562040c
y.create.l HWIO_MCDMA_LOG_HW_CH1_SYNC_ADDR A:0x65620410
y.create.l HWIO_MCDMA_LOG_HW_CH2_SYNC_ADDR A:0x65620414
y.create.l HWIO_MCDMA_LOG_HW_CH3_SYNC_ADDR A:0x65620418
y.create.l HWIO_MCDMA_LOG_HW_CH0_CTL_ADDR A:0x65620424
y.create.l HWIO_MCDMA_LOG_HW_CH1_CTL_ADDR A:0x65620428
y.create.l HWIO_MCDMA_LOG_HW_CH2_CTL_ADDR A:0x6562042c
y.create.l HWIO_MCDMA_LOG_HW_CH3_CTL_ADDR A:0x65620430
y.create.l HWIO_MCDMA_LOG_SW_CH0_RESET_ADDR A:0x65620440
y.create.l HWIO_MCDMA_LOG_SW_CH1_RESET_ADDR A:0x65620444
y.create.l HWIO_MCDMA_LOG_SW_CH2_RESET_ADDR A:0x65620448
y.create.l HWIO_MCDMA_LOG_SW_CH3_RESET_ADDR A:0x6562044c
y.create.l HWIO_MCDMA_LOG_SW_CH4_RESET_ADDR A:0x65620450
y.create.l HWIO_MCDMA_LOG_SW_CH5_RESET_ADDR A:0x65620454
y.create.l HWIO_MCDMA_LOG_SW_CH6_RESET_ADDR A:0x65620458
y.create.l HWIO_MCDMA_LOG_SW_CH7_RESET_ADDR A:0x6562045c
y.create.l HWIO_MCDMA_LOG_SW_CH8_RESET_ADDR A:0x65620460
y.create.l HWIO_MCDMA_LOG_SW_CH9_RESET_ADDR A:0x65620464
y.create.l HWIO_MCDMA_LOG_SW_CH0_CTL_ADDR A:0x65620468
y.create.l HWIO_MCDMA_LOG_SW_CH1_CTL_ADDR A:0x6562046c
y.create.l HWIO_MCDMA_LOG_SW_CH2_CTL_ADDR A:0x65620470
y.create.l HWIO_MCDMA_LOG_SW_CH3_CTL_ADDR A:0x65620474
y.create.l HWIO_MCDMA_LOG_SW_CH4_CTL_ADDR A:0x65620478
y.create.l HWIO_MCDMA_LOG_SW_CH5_CTL_ADDR A:0x6562047c
y.create.l HWIO_MCDMA_LOG_SW_CH6_CTL_ADDR A:0x65620480
y.create.l HWIO_MCDMA_LOG_SW_CH7_CTL_ADDR A:0x65620484
y.create.l HWIO_MCDMA_LOG_SW_CH8_CTL_ADDR A:0x65620488
y.create.l HWIO_MCDMA_LOG_SW_CH9_CTL_ADDR A:0x6562048c
y.create.l HWIO_MCDMA_PHY_CH_CTL_ADDR A:0x65620494
y.create.l HWIO_MCDMA_LOG_HW_CH0_DBG_ADDR A:0x65620498
y.create.l HWIO_MCDMA_LOG_HW_CH1_DBG_ADDR A:0x6562049c
y.create.l HWIO_MCDMA_LOG_HW_CH2_DBG_ADDR A:0x656204a0
y.create.l HWIO_MCDMA_LOG_HW_CH3_DBG_ADDR A:0x656204a4
y.create.l HWIO_MCDMA_LOG_SW_CH0_DBG_ADDR A:0x656204b0
y.create.l HWIO_MCDMA_LOG_SW_CH1_DBG_ADDR A:0x656204b4
y.create.l HWIO_MCDMA_LOG_SW_CH2_DBG_ADDR A:0x656204b8
y.create.l HWIO_MCDMA_LOG_SW_CH3_DBG_ADDR A:0x656204bc
y.create.l HWIO_MCDMA_LOG_SW_CH4_DBG_ADDR A:0x656204c0
y.create.l HWIO_MCDMA_LOG_SW_CH5_DBG_ADDR A:0x656204c4
y.create.l HWIO_MCDMA_LOG_SW_CH6_DBG_ADDR A:0x656204c8
y.create.l HWIO_MCDMA_LOG_SW_CH7_DBG_ADDR A:0x656204cc
y.create.l HWIO_MCDMA_LOG_SW_CH8_DBG_ADDR A:0x656204d0
y.create.l HWIO_MCDMA_LOG_SW_CH9_DBG_ADDR A:0x656204d4
y.create.l HWIO_MCDMA_PHY_CH_DBG_ADDR A:0x656204dc
y.create.l HWIO_MCDMA_VBUF_CFG_DBG_ADDR A:0x656204e0
y.create.l HWIO_MCDMA_VBUF_CFG_SEL_ADDR A:0x656204e4
y.create.l HWIO_MCDMA_VBUF_CFG_RD0_ADDR A:0x656204e8
y.create.l HWIO_MCDMA_VBUF_CFG_RD1_ADDR A:0x656204ec
y.create.l HWIO_A2_SW_RESET_THRD_ADDR A:0x65620800
y.create.l HWIO_A2_TASK0_EN_ADDR A:0x65620808
y.create.l HWIO_A2_TASK1_EN_ADDR A:0x6562080c
y.create.l HWIO_A2_TASK2_EN_ADDR A:0x65620810
y.create.l HWIO_A2_TASK3_EN_ADDR A:0x65620814
y.create.l HWIO_A2_TASK4_EN_ADDR A:0x65620818
y.create.l HWIO_A2_TASK5_EN_ADDR A:0x6562081c
y.create.l HWIO_A2_TASK0_WR_PTR_ADDR A:0x65620820
y.create.l HWIO_A2_TASK1_WR_PTR_ADDR A:0x65620824
y.create.l HWIO_A2_TASK2_WR_PTR_ADDR A:0x65620828
y.create.l HWIO_A2_TASK3_WR_PTR_ADDR A:0x6562082c
y.create.l HWIO_A2_TASK4_WR_PTR_ADDR A:0x65620830
y.create.l HWIO_A2_TASK5_WR_PTR_ADDR A:0x65620834
y.create.l HWIO_A2_TASK0_RD_PTR_ADDR A:0x65620838
y.create.l HWIO_A2_TASK1_RD_PTR_ADDR A:0x6562083c
y.create.l HWIO_A2_TASK2_RD_PTR_ADDR A:0x65620840
y.create.l HWIO_A2_TASK3_RD_PTR_ADDR A:0x65620844
y.create.l HWIO_A2_TASK4_RD_PTR_ADDR A:0x65620848
y.create.l HWIO_A2_TASK5_RD_PTR_ADDR A:0x6562084c
y.create.l HWIO_A2_TASK0_RD_PTR_INIT_ADDR A:0x65620850
y.create.l HWIO_A2_TASK1_RD_PTR_INIT_ADDR A:0x65620854
y.create.l HWIO_A2_TASK2_RD_PTR_INIT_ADDR A:0x65620858
y.create.l HWIO_A2_TASK3_RD_PTR_INIT_ADDR A:0x6562085c
y.create.l HWIO_A2_TASK4_RD_PTR_INIT_ADDR A:0x65620860
y.create.l HWIO_A2_TASK5_RD_PTR_INIT_ADDR A:0x65620864
y.create.l HWIO_A2_TASK0_RD_PTR_INIT_EN_ADDR A:0x65620868
y.create.l HWIO_A2_TASK1_RD_PTR_INIT_EN_ADDR A:0x6562086c
y.create.l HWIO_A2_TASK2_RD_PTR_INIT_EN_ADDR A:0x65620870
y.create.l HWIO_A2_TASK3_RD_PTR_INIT_EN_ADDR A:0x65620874
y.create.l HWIO_A2_TASK4_RD_PTR_INIT_EN_ADDR A:0x65620878
y.create.l HWIO_A2_TASK5_RD_PTR_INIT_EN_ADDR A:0x6562087c
y.create.l HWIO_A2_QUEUE_UPPER_ADDR_ADDR A:0x65620880
y.create.l HWIO_A2_STATUS0_WR_EN_ADDR A:0x65620884
y.create.l HWIO_A2_STATUS1_WR_EN_ADDR A:0x65620888
y.create.l HWIO_A2_STATUS2_WR_EN_ADDR A:0x6562088c
y.create.l HWIO_A2_STATUS3_WR_EN_ADDR A:0x65620890
y.create.l HWIO_A2_STATUS4_WR_EN_ADDR A:0x65620894
y.create.l HWIO_A2_STATUS5_WR_EN_ADDR A:0x65620898
y.create.l HWIO_A2_STATUS0_WR_START_ADDR A:0x6562089c
y.create.l HWIO_A2_STATUS1_WR_START_ADDR A:0x656208a0
y.create.l HWIO_A2_STATUS2_WR_START_ADDR A:0x656208a4
y.create.l HWIO_A2_STATUS3_WR_START_ADDR A:0x656208a8
y.create.l HWIO_A2_STATUS4_WR_START_ADDR A:0x656208ac
y.create.l HWIO_A2_STATUS5_WR_START_ADDR A:0x656208b0
y.create.l HWIO_A2_STATUS0_WR_END_ADDR A:0x656208b4
y.create.l HWIO_A2_STATUS1_WR_END_ADDR A:0x656208b8
y.create.l HWIO_A2_STATUS2_WR_END_ADDR A:0x656208bc
y.create.l HWIO_A2_STATUS3_WR_END_ADDR A:0x656208c0
y.create.l HWIO_A2_STATUS4_WR_END_ADDR A:0x656208c4
y.create.l HWIO_A2_STATUS5_WR_END_ADDR A:0x656208c8
y.create.l HWIO_A2_STATUS0_WR_PTR_INIT_ADDR A:0x656208cc
y.create.l HWIO_A2_STATUS1_WR_PTR_INIT_ADDR A:0x656208d0
y.create.l HWIO_A2_STATUS2_WR_PTR_INIT_ADDR A:0x656208d4
y.create.l HWIO_A2_STATUS3_WR_PTR_INIT_ADDR A:0x656208d8
y.create.l HWIO_A2_STATUS4_WR_PTR_INIT_ADDR A:0x656208dc
y.create.l HWIO_A2_STATUS5_WR_PTR_INIT_ADDR A:0x656208e0
y.create.l HWIO_A2_STATUS0_WR_PTR_INIT_EN_ADDR A:0x656208e4
y.create.l HWIO_A2_STATUS1_WR_PTR_INIT_EN_ADDR A:0x656208e8
y.create.l HWIO_A2_STATUS2_WR_PTR_INIT_EN_ADDR A:0x656208ec
y.create.l HWIO_A2_STATUS3_WR_PTR_INIT_EN_ADDR A:0x656208f0
y.create.l HWIO_A2_STATUS4_WR_PTR_INIT_EN_ADDR A:0x656208f4
y.create.l HWIO_A2_STATUS5_WR_PTR_INIT_EN_ADDR A:0x656208f8
y.create.l HWIO_A2_STATUS0_WR_PTR_CURRENT_ADDR A:0x656208fc
y.create.l HWIO_A2_STATUS1_WR_PTR_CURRENT_ADDR A:0x65620900
y.create.l HWIO_A2_STATUS2_WR_PTR_CURRENT_ADDR A:0x65620904
y.create.l HWIO_A2_STATUS3_WR_PTR_CURRENT_ADDR A:0x65620908
y.create.l HWIO_A2_STATUS4_WR_PTR_CURRENT_ADDR A:0x6562090c
y.create.l HWIO_A2_STATUS5_WR_PTR_CURRENT_ADDR A:0x65620910
y.create.l HWIO_A2_STATUS0_WR_PTR_ADDR A:0x65620914
y.create.l HWIO_A2_STATUS1_WR_PTR_ADDR A:0x65620918
y.create.l HWIO_A2_STATUS2_WR_PTR_ADDR A:0x6562091c
y.create.l HWIO_A2_STATUS3_WR_PTR_ADDR A:0x65620920
y.create.l HWIO_A2_STATUS4_WR_PTR_ADDR A:0x65620924
y.create.l HWIO_A2_STATUS5_WR_PTR_ADDR A:0x65620928
y.create.l HWIO_A2_STATUS0_RD_PTR_ADDR A:0x65620b04
y.create.l HWIO_A2_STATUS1_RD_PTR_ADDR A:0x65620b08
y.create.l HWIO_A2_STATUS2_RD_PTR_ADDR A:0x65620b0c
y.create.l HWIO_A2_STATUS3_RD_PTR_ADDR A:0x65620b10
y.create.l HWIO_A2_STATUS4_RD_PTR_ADDR A:0x65620b14
y.create.l HWIO_A2_STATUS5_RD_PTR_ADDR A:0x65620b18
y.create.l HWIO_A2_FRAG0_THRESHOLD_ADDR A:0x6562092c
y.create.l HWIO_A2_FRAG1_THRESHOLD_ADDR A:0x65620930
y.create.l HWIO_A2_FRAG0_REFILL_EN_ADDR A:0x65620934
y.create.l HWIO_A2_FRAG1_REFILL_EN_ADDR A:0x65620938
y.create.l HWIO_A2_FRAG0_LEN_ADDR A:0x6562093c
y.create.l HWIO_A2_FRAG1_LEN_ADDR A:0x65620940
y.create.l HWIO_A2_FRAG0_QUEUE_END_ADDR_ADDR A:0x65620944
y.create.l HWIO_A2_FRAG1_QUEUE_END_ADDR_ADDR A:0x65620948
y.create.l HWIO_A2_FRAG0_PTR_ADDR A:0x6562094c
y.create.l HWIO_A2_FRAG1_PTR_ADDR A:0x65620950
y.create.l HWIO_A2_FRAG_CACHE_LINE_ADDR A:0x65620954
y.create.l HWIO_A2_FRAG_CACHE_LINE_MASK_ADDR A:0x65620958
y.create.l HWIO_A2_FRAG0_TRANSFER_LEN_ADDR A:0x6562095c
y.create.l HWIO_A2_FRAG1_TRANSFER_LEN_ADDR A:0x65620960
y.create.l HWIO_A2_FRAG0_HDR_LEN_ADDR A:0x65620964
y.create.l HWIO_A2_FRAG1_HDR_LEN_ADDR A:0x65620968
y.create.l HWIO_A2_FRAG0_QUEUE_START_ADDR_ADDR A:0x6562096c
y.create.l HWIO_A2_FRAG1_QUEUE_START_ADDR_ADDR A:0x65620970
y.create.l HWIO_A2_FRAG0_QUEUE_WR_PTR_ADDR A:0x65620974
y.create.l HWIO_A2_FRAG1_QUEUE_WR_PTR_ADDR A:0x65620978
y.create.l HWIO_A2_FRAG0_QUEUE_RD_PTR_ADDR A:0x6562097c
y.create.l HWIO_A2_FRAG1_QUEUE_RD_PTR_ADDR A:0x65620980
y.create.l HWIO_A2_FRAG0_RD_PTR_INIT_EN_ADDR A:0x65620984
y.create.l HWIO_A2_FRAG1_RD_PTR_INIT_EN_ADDR A:0x65620988
y.create.l HWIO_A2_TIMER0_CFG_ADDR A:0x6562098c
y.create.l HWIO_A2_TIMER1_CFG_ADDR A:0x65620990
y.create.l HWIO_A2_TIMER2_CFG_ADDR A:0x65620994
y.create.l HWIO_A2_TIMER3_CFG_ADDR A:0x65620998
y.create.l HWIO_A2_TIMER0_CMD_ADDR A:0x6562099c
y.create.l HWIO_A2_TIMER1_CMD_ADDR A:0x656209a0
y.create.l HWIO_A2_TIMER2_CMD_ADDR A:0x656209a4
y.create.l HWIO_A2_TIMER3_CMD_ADDR A:0x656209a8
y.create.l HWIO_A2_TIMER0_PERIOD_ADDR A:0x656209ac
y.create.l HWIO_A2_TIMER1_PERIOD_ADDR A:0x656209b0
y.create.l HWIO_A2_TIMER2_PERIOD_ADDR A:0x656209b4
y.create.l HWIO_A2_TIMER3_PERIOD_ADDR A:0x656209b8
y.create.l HWIO_A2_TIMER0_STATUS_ADDR A:0x656209bc
y.create.l HWIO_A2_TIMER1_STATUS_ADDR A:0x656209c0
y.create.l HWIO_A2_TIMER2_STATUS_ADDR A:0x656209c4
y.create.l HWIO_A2_TIMER3_STATUS_ADDR A:0x656209c8
y.create.l HWIO_A2_DL_PHY_DEC_TRBLK_THRESHOLD_ADDR A:0x656209cc
y.create.l HWIO_A2_DL_PHY_CFG_ADDR A:0x656209d0
y.create.l HWIO_A2_DL_PHY_1_DEC_TRBLK_THRESHOLD_ADDR A:0x656209d4
y.create.l HWIO_A2_DL_PHY_1_CFG_ADDR A:0x656209d8
y.create.l HWIO_A2_HW_THRD_EN_ADDR A:0x656209dc
y.create.l HWIO_A2_UL_PHY_CFG_ADDR A:0x656209e0
y.create.l HWIO_A2_UL_PHY_1_CFG_ADDR A:0x656209e4
y.create.l HWIO_A2_LTE_DLPHY_CMD_ADDR_ADDR A:0x656209e8
y.create.l HWIO_A2_LTE_DLPHY_1_CMD_ADDR_ADDR A:0x656209ec
y.create.l HWIO_A2_MCDMA_DMA_IN_ADDR_ADDR A:0x656209f0
y.create.l HWIO_A2_MCDMA_DMA_OUT_ADDR_ADDR A:0x656209f4
y.create.l HWIO_A2_MCDMA_TASK_ADDR_ADDR A:0x656209f8
y.create.l HWIO_A2_MCDMA_OST_BRST_ADDR A:0x65620a04
y.create.l HWIO_A2_MCDMA_MAX_BRST_SIZE_ADDR A:0x65620a08
y.create.l HWIO_A2_HW_CLK_CTL_ADDR A:0x65620a0c
y.create.l HWIO_A2_CLK_EN_CTL_ADDR A:0x65620a10
y.create.l HWIO_A2_CLK_STATUS_ADDR A:0x65620a14
y.create.l HWIO_A2_DBG_LINK_RD0_ADDR A:0x65620a18
y.create.l HWIO_A2_DBG_LINK_RD1_ADDR A:0x65620a1c
y.create.l HWIO_A2_DBG_LINK_RD2_ADDR A:0x65620a20
y.create.l HWIO_A2_DBG_LINK_RD3_ADDR A:0x65620a24
y.create.l HWIO_A2_DBG_LINK_RD4_ADDR A:0x65620a28
y.create.l HWIO_A2_DBG_LINK_RD5_ADDR A:0x65620a2c
y.create.l HWIO_A2_DBG_LINK_RD6_ADDR A:0x65620a30
y.create.l HWIO_A2_DBG_LINK_RD7_ADDR A:0x65620a34
y.create.l HWIO_A2_DBG_LINK_RD8_ADDR A:0x65620a38
y.create.l HWIO_A2_DBG_LINK_RD9_ADDR A:0x65620a3c
y.create.l HWIO_A2_DBG_FRAG0_LEN_ADDR A:0x65620a48
y.create.l HWIO_A2_DBG_FRAG1_LEN_ADDR A:0x65620a4c
y.create.l HWIO_A2_DBG_FRAG2_LEN_ADDR A:0x65620a50
y.create.l HWIO_A2_DBG_FRAG3_LEN_ADDR A:0x65620a54
y.create.l HWIO_A2_DBG_FRAG4_LEN_ADDR A:0x65620a58
y.create.l HWIO_A2_DBG_FRAG5_LEN_ADDR A:0x65620a5c
y.create.l HWIO_A2_DBG_FRAG0_ADDR_CUR_ADDR A:0x65620a60
y.create.l HWIO_A2_DBG_FRAG1_ADDR_CUR_ADDR A:0x65620a64
y.create.l HWIO_A2_DBG_FRAG2_ADDR_CUR_ADDR A:0x65620a68
y.create.l HWIO_A2_DBG_FRAG3_ADDR_CUR_ADDR A:0x65620a6c
y.create.l HWIO_A2_DBG_FRAG4_ADDR_CUR_ADDR A:0x65620a70
y.create.l HWIO_A2_DBG_FRAG5_ADDR_CUR_ADDR A:0x65620a74
y.create.l HWIO_A2_DBG_FRAG0_ADDR_NXT_ADDR A:0x65620a78
y.create.l HWIO_A2_DBG_FRAG1_ADDR_NXT_ADDR A:0x65620a7c
y.create.l HWIO_A2_DBG_FRAG2_ADDR_NXT_ADDR A:0x65620a80
y.create.l HWIO_A2_DBG_FRAG3_ADDR_NXT_ADDR A:0x65620a84
y.create.l HWIO_A2_DBG_FRAG4_ADDR_NXT_ADDR A:0x65620a88
y.create.l HWIO_A2_DBG_FRAG5_ADDR_NXT_ADDR A:0x65620a8c
y.create.l HWIO_A2_DBG_FRAG0_PTR_ADDR A:0x65620a90
y.create.l HWIO_A2_DBG_FRAG1_PTR_ADDR A:0x65620a94
y.create.l HWIO_A2_DBG_FRAG2_PTR_ADDR A:0x65620a98
y.create.l HWIO_A2_DBG_FRAG3_PTR_ADDR A:0x65620a9c
y.create.l HWIO_A2_DBG_FRAG4_PTR_ADDR A:0x65620aa0
y.create.l HWIO_A2_DBG_FRAG5_PTR_ADDR A:0x65620aa4
y.create.l HWIO_A2_DBG_TRBLK_LENGTH_ADDR A:0x65620aa8
y.create.l HWIO_A2_DBG_TRBLK_START_ADDR_ADDR A:0x65620aac
y.create.l HWIO_A2_DBG_TRBLK_SW_INFO0_ADDR A:0x65620ab0
y.create.l HWIO_A2_DBG_TRBLK_SW_INFO1_ADDR A:0x65620ab4
y.create.l HWIO_A2_DBG_TRBLK_TRIGGER_ADDR A:0x65620ab8
y.create.l HWIO_A2_DBG_TRBLK_STATUS_ADDR A:0x65620abc
y.create.l HWIO_A2_DBG_TRBLK_1_LENGTH_ADDR A:0x65620ac0
y.create.l HWIO_A2_DBG_TRBLK_1_START_ADDR_ADDR A:0x65620ac4
y.create.l HWIO_A2_DBG_TRBLK_1_SW_INFO0_ADDR A:0x65620ac8
y.create.l HWIO_A2_DBG_TRBLK_1_SW_INFO1_ADDR A:0x65620acc
y.create.l HWIO_A2_DBG_TRBLK_1_STATUS_ADDR A:0x65620ad4
y.create.l HWIO_A2_DBG_STRM_ID_ADDR A:0x65620ad8
y.create.l HWIO_A2_DBG_DMA_SRC_ADDR A:0x65620adc
y.create.l HWIO_A2_DBG_DMA_DST_ADDR A:0x65620ae0
y.create.l HWIO_A2_DBG_DMA_CTL_ADDR A:0x65620ae4
y.create.l HWIO_A2_DBG_TASK_FETCHER_ADDR A:0x65620ae8
y.create.l HWIO_A2_DBG_CIPH_ADDR A:0x65620aec
y.create.l HWIO_A2_DBG_MIU0_ADDR A:0x65620af0
y.create.l HWIO_A2_DBG_MIU1_ADDR A:0x65620af4
y.create.l HWIO_A2_DBG_MIU2_ADDR A:0x65620af8
y.create.l HWIO_A2_DBG_TASK_WORD_ADDR A:0x65620afc
y.create.l HWIO_A2_DBG_TASK_INFO_ADDR A:0x65620b00
y.create.l HWIO_A2_DBG_MISC_EN_ADDR A:0x65620b1c
y.create.l HWIO_DBG_RESET_ADDR A:0x65620c00
y.create.l HWIO_DBG_ENABLE_ADDR A:0x65620c04
y.create.l HWIO_DBG_LOG_STATUS_ADDR A:0x65620c08
y.create.l HWIO_DBG_MUX_MASK_0_ADDR A:0x65620c0c
y.create.l HWIO_DBG_MUX_MASK_1_ADDR A:0x65620c10
y.create.l HWIO_DBG_MUX_MASK_2_ADDR A:0x65620c14
y.create.l HWIO_DBG_MUX_MASK_3_ADDR A:0x65620c18
y.create.l HWIO_DBG_MUX_MASK_4_ADDR A:0x65620c1c
y.create.l HWIO_DBG_MUX_MASK_5_ADDR A:0x65620c20
y.create.l HWIO_DBG_MUX_MASK_6_ADDR A:0x65620c24
y.create.l HWIO_DBG_MUX_MASK_7_ADDR A:0x65620c28
y.create.l HWIO_DBG_MUX_MASK_8_ADDR A:0x65620c2c
y.create.l HWIO_DBG_MUX_MASK_9_ADDR A:0x65620c30
y.create.l HWIO_DBG_SW_LOG_STATUS_ADDR A:0x65620c4c
y.create.l HWIO_DBG_ERR_IRQ_MASK0_ADDR A:0x65620c50
y.create.l HWIO_DBG_SW_LOG_ADDR A:0x65620c58
y.create.l HWIO_DBG_DATA_DST_ADDR A:0x65620c5c
y.create.l HWIO_DBG_START_ADDR_ADDR A:0x65620c60
y.create.l HWIO_DBG_EXT_MEM_CNT_VAL_ADDR A:0x65620c64
y.create.l HWIO_DBG_SHRD_START_ADDR_ADDR A:0x65620c68
y.create.l HWIO_DBG_SHRD_END_ADDR_ADDR A:0x65620c6c
y.create.l HWIO_DBG_MAX_OST_BURSTS_ADDR A:0x65620c70
y.create.l HWIO_DBG_ERR_IRQ_EN0_ADDR A:0x65620c74
y.create.l HWIO_DBG_ERR_IRQ_CLR0_ADDR A:0x65620c7c
y.create.l HWIO_DBG_ERR_IRQ_STATUS0_ADDR A:0x65620c84
y.create.l HWIO_MTC_BRDG_MCDMA_RD_ENABLE_ADDR A:0x6562100c
y.create.l HWIO_MTC_BRDG_MCDMA_WR_ENABLE_ADDR A:0x65621010
y.create.l HWIO_MTC_BRDG_A2_RD_ENABLE_ADDR A:0x65621014
y.create.l HWIO_MTC_BRDG_CTL_ADDR A:0x65621000
y.create.l HWIO_MTC_BRDG_STATUS_ADDR A:0x65621004
y.create.l HWIO_MTC_BRDG_CLEAR_ADDR A:0x65621008
y.create.l HWIO_A2_SHRD_MEM_BASE_MIN_ADDR A:0x65622000
y.create.l HWIO_A2_SHRD_MEM_BASE_MAX_ADDR A:0x6562367c
y.create.l HWIO_MCDMA_TS_STATUS_WORD0_ADDR A:0x65624000
y.create.l HWIO_MCDMA_TS_VBUF_CFG_WORD0_ADDR A:0x65624100
y.create.l HWIO_MCDMA_TS_VBUF_CFG_WORD1_ADDR A:0x65624104
y.create.l HWIO_MCDMA_TS_DMA_CH0_WORD0_ADDR A:0x65624200
y.create.l HWIO_MCDMA_TS_DMA_CH0_WORD1_ADDR A:0x65624204
y.create.l HWIO_MCDMA_TS_DMA_CH0_WORD2_ADDR A:0x65624208
y.create.l HWIO_MCDMA_TS_DMA_CH1_WORD0_ADDR A:0x65624300
y.create.l HWIO_MCDMA_TS_DMA_CH1_WORD1_ADDR A:0x65624304
y.create.l HWIO_MCDMA_TS_DMA_CH1_WORD2_ADDR A:0x65624308
y.create.l HWIO_MCDMA_TS_DMA_CH2_WORD0_ADDR A:0x65624400
y.create.l HWIO_MCDMA_TS_DMA_CH2_WORD1_ADDR A:0x65624404
y.create.l HWIO_MCDMA_TS_DMA_CH2_WORD2_ADDR A:0x65624408
y.create.l HWIO_MCDMA_TS_DMA_CH3_WORD0_ADDR A:0x65624500
y.create.l HWIO_MCDMA_TS_DMA_CH3_WORD1_ADDR A:0x65624504
y.create.l HWIO_MCDMA_TS_DMA_CH3_WORD2_ADDR A:0x65624508
y.create.l HWIO_MCDMA_TS_DMA_CH4_WORD0_ADDR A:0x65624600
y.create.l HWIO_MCDMA_TS_DMA_CH4_WORD1_ADDR A:0x65624604
y.create.l HWIO_MCDMA_TS_DMA_CH5_WORD0_ADDR A:0x65624700
y.create.l HWIO_MCDMA_TS_DMA_CH5_WORD1_ADDR A:0x65624704
y.create.l HWIO_MCDMA_TS_DMA_CH6_WORD0_ADDR A:0x65624800
y.create.l HWIO_MCDMA_TS_DMA_CH6_WORD1_ADDR A:0x65624804
y.create.l HWIO_MCDMA_TS_DMA_CH6_WORD2_ADDR A:0x65624808
y.create.l HWIO_MCDMA_TS_DMA_CH7_WORD0_ADDR A:0x65624900
y.create.l HWIO_MCDMA_TS_DMA_CH7_WORD1_ADDR A:0x65624904
y.create.l HWIO_MCDMA_TS_DMA_CH7_WORD2_ADDR A:0x65624908
y.create.l HWIO_MCDMA_TS_DMA_CH8_WORD0_ADDR A:0x65624a00
y.create.l HWIO_MCDMA_TS_DMA_CH8_WORD1_ADDR A:0x65624a04
y.create.l HWIO_MCDMA_TS_DMA_CH8_WORD2_ADDR A:0x65624a08
y.create.l HWIO_MCDMA_TS_DMA_CH9_WORD0_ADDR A:0x65624b00
y.create.l HWIO_MCDMA_TS_DMA_CH9_WORD1_ADDR A:0x65624b04
y.create.l HWIO_MCDMA_TS_DMA_CH9_WORD2_ADDR A:0x65624b08
y.create.l HWIO_TDEC_CLK_CTL_ADDR A:0x65640000
y.create.l HWIO_TDEC_SW_CLK_EN_ADDR A:0x65640004
y.create.l HWIO_TDEC_CLK_STATUS_REG_ADDR A:0x65640008
y.create.l HWIO_TDEC_MODE_CTL_ADDR A:0x6564000c
y.create.l HWIO_TDECIB_CLK_CTL_ADDR A:0x65640010
y.create.l HWIO_TDECIB_SW_CLK_EN_ADDR A:0x65640014
y.create.l HWIO_TDECIB_CLK_STATUS_ADDR A:0x65640018
y.create.l HWIO_TD_COMMON_CFG0_ADDR A:0x65640020
y.create.l HWIO_TD_COMMON_CFG1_ADDR A:0x65640024
y.create.l HWIO_TD_COMMON_CFG2_ADDR A:0x65640028
y.create.l HWIO_TD_COMMON_CFG3_ADDR A:0x6564002c
y.create.l HWIO_TD_COMMON_CFG4_ADDR A:0x65640030
y.create.l HWIO_TD_COMMON_CFG5_ADDR A:0x65640034
y.create.l HWIO_TD_COMMON_START_ADDR A:0x65640038
y.create.l HWIO_TD_1X_CFG_ADDR A:0x6564003c
y.create.l HWIO_TD_1X_DECOB_WRITE_PTR_ADDR A:0x65640040
y.create.l HWIO_TDEC_HW_IDLE_ADDR A:0x65640044
y.create.l HWIO_TDEC_PING_STATUS_0_ADDR A:0x65640048
y.create.l HWIO_TDEC_PING_STATUS_1_ADDR A:0x6564004c
y.create.l HWIO_TDEC_PONG_STATUS_0_ADDR A:0x65640050
y.create.l HWIO_TDEC_PONG_STATUS_1_ADDR A:0x65640054
y.create.l HWIO_TDEC_GERAN_STATUS_0_ADDR A:0x65640058
y.create.l HWIO_TDEC_GERAN_STATUS_1_ADDR A:0x6564005c
y.create.l HWIO_TDEC_TESTBUS_ENABLE_ADDR A:0x65640060
y.create.l HWIO_TDEC_TESTBUS_STATUS_ADDR A:0x65640064
y.create.l HWIO_DECIB_PAGE_ID_ADDR A:0x65640068
y.create.l HWIO_TDEC_AHB_ERROR_ADDR_RD_ADDR A:0x65640070
y.create.l HWIO_TEST_CRC_000_RD_ADDR A:0x65640074
y.create.l HWIO_TEST_CRC_001_RD_ADDR A:0x65640078
y.create.l HWIO_TEST_CRC_010_RD_ADDR A:0x6564007c
y.create.l HWIO_TEST_CRC_011_RD_ADDR A:0x65640080
y.create.l HWIO_TEST_CRC_100_RD_ADDR A:0x65640084
y.create.l HWIO_TEST_CRC_101_RD_ADDR A:0x65640088
y.create.l HWIO_TEST_CRC_110_RD_ADDR A:0x6564008c
y.create.l HWIO_TEST_CRC_111_RD_ADDR A:0x65640090
y.create.l HWIO_A2_TEST_SW_CFG_DATA0_ADDR A:0x65640094
y.create.l HWIO_A2_TEST_SW_CFG_DATA1_ADDR A:0x65640098
y.create.l HWIO_A2_TEST_SW_CFG_DATA2_ADDR A:0x6564009c
y.create.l HWIO_A2_TEST_SW_CFG_DATA3_ADDR A:0x656400a0
y.create.l HWIO_A2_TEST_SW_CFG_DATA4_ADDR A:0x656400a4
y.create.l HWIO_TD_CFG_STATUS_WORD0_ADDR A:0x65641000
y.create.l HWIO_LTE_CFG_WORD0_ADDR A:0x65641100
y.create.l HWIO_LTE_CFG_WORD1_ADDR A:0x65641104
y.create.l HWIO_LTE_CFG_WORD2_ADDR A:0x65641108
y.create.l HWIO_W_TD_CFG_WORD0_0_ADDR A:0x65641200
y.create.l HWIO_W_TD_CFG_WORD1_0_ADDR A:0x65641204
y.create.l HWIO_W_TD_CFG_WORD2_0_ADDR A:0x65641208
y.create.l HWIO_W_TD_CFG_WORD3_0_ADDR A:0x6564120c
y.create.l HWIO_W_TD_CFG_WORD4_0_ADDR A:0x65641210
y.create.l HWIO_W_TD_CFG_WORD5_0_ADDR A:0x65641214
y.create.l HWIO_W_TD_CFG_WORD6_0_ADDR A:0x65641218
y.create.l HWIO_W_TD_CFG_WORD7_0_ADDR A:0x6564121c
y.create.l HWIO_W_TD_CFG_WORD8_0_ADDR A:0x65641220
y.create.l HWIO_W_TD_CFG_WORD9_0_ADDR A:0x65641224
y.create.l HWIO_W_TD_CFG_WORD0_1_ADDR A:0x65641300
y.create.l HWIO_W_TD_CFG_WORD1_1_ADDR A:0x65641304
y.create.l HWIO_W_TD_CFG_WORD2_1_ADDR A:0x65641308
y.create.l HWIO_W_TD_CFG_WORD3_1_ADDR A:0x6564130c
y.create.l HWIO_W_TD_CFG_WORD4_1_ADDR A:0x65641310
y.create.l HWIO_W_TD_CFG_WORD5_1_ADDR A:0x65641314
y.create.l HWIO_W_TD_CFG_WORD6_1_ADDR A:0x65641318
y.create.l HWIO_W_TD_CFG_WORD7_1_ADDR A:0x6564131c
y.create.l HWIO_W_TD_CFG_WORD8_1_ADDR A:0x65641320
y.create.l HWIO_W_TD_CFG_WORD9_1_ADDR A:0x65641324
y.create.l HWIO_LTE_TRBLK_CFG_WORD0_0_ADDR A:0x65641400
y.create.l HWIO_LTE_TRBLK_CFG_WORD1_0_ADDR A:0x65641404
y.create.l HWIO_LTE_TRBLK_CFG_WORD2_0_ADDR A:0x65641408
y.create.l HWIO_LTE_TRBLK_CFG_WORD3_0_ADDR A:0x6564140c
y.create.l HWIO_LTE_TRBLK_CFG_WORD4_0_ADDR A:0x65641410
y.create.l HWIO_LTE_TRBLK_CFG_WORD5_0_ADDR A:0x65641414
y.create.l HWIO_LTE_TRBLK_CFG_WORD0_1_ADDR A:0x65641500
y.create.l HWIO_LTE_TRBLK_CFG_WORD1_1_ADDR A:0x65641504
y.create.l HWIO_LTE_TRBLK_CFG_WORD2_1_ADDR A:0x65641508
y.create.l HWIO_LTE_TRBLK_CFG_WORD3_1_ADDR A:0x6564150c
y.create.l HWIO_LTE_TRBLK_CFG_WORD4_1_ADDR A:0x65641510
y.create.l HWIO_LTE_TRBLK_CFG_WORD5_1_ADDR A:0x65641514
y.create.l HWIO_GERAN_TD_CFG_WORD0_0_ADDR A:0x65641600
y.create.l HWIO_GERAN_TD_CFG_WORD1_0_ADDR A:0x65641604
y.create.l HWIO_GERAN_TD_CFG_WORD2_0_ADDR A:0x65641608
y.create.l HWIO_GERAN_TD_CFG_WORD3_0_ADDR A:0x6564160c
y.create.l HWIO_GERAN_TD_CFG_WORD0_1_ADDR A:0x65641700
y.create.l HWIO_GERAN_TD_CFG_WORD1_1_ADDR A:0x65641704
y.create.l HWIO_GERAN_TD_CFG_WORD2_1_ADDR A:0x65641708
y.create.l HWIO_GERAN_TD_CFG_WORD3_1_ADDR A:0x6564170c
y.create.l HWIO_HDR_TD_CFG_WORD0_0_ADDR A:0x65641800
y.create.l HWIO_HDR_TD_CFG_WORD1_0_ADDR A:0x65641804
y.create.l HWIO_HDR_TD_CFG_WORD2_0_ADDR A:0x65641808
y.create.l HWIO_HDR_TD_CFG_WORD0_1_ADDR A:0x65641900
y.create.l HWIO_HDR_TD_CFG_WORD1_1_ADDR A:0x65641904
y.create.l HWIO_HDR_TD_CFG_WORD2_1_ADDR A:0x65641908
y.create.l HWIO_TD_STATUS_WORD0_ADDR A:0x65642000
y.create.l HWIO_W_TD_WORD0_0_ADDR A:0x65642100
y.create.l HWIO_W_TD_WORD0_1_ADDR A:0x65642200
y.create.l HWIO_LTE_PDSCH_WORD0_0_ADDR A:0x65642300
y.create.l HWIO_LTE_PDSCH_WORD1_0_ADDR A:0x65642304
y.create.l HWIO_LTE_PDSCH_WORD2_0_ADDR A:0x65642308
y.create.l HWIO_LTE_PDSCH_WORD0_1_ADDR A:0x65642400
y.create.l HWIO_LTE_PDSCH_WORD1_1_ADDR A:0x65642404
y.create.l HWIO_LTE_PDSCH_WORD2_1_ADDR A:0x65642408
y.create.l HWIO_GERAN_TD_WORD0_0_ADDR A:0x65642500
y.create.l HWIO_GERAN_TD_WORD1_0_ADDR A:0x65642504
y.create.l HWIO_GERAN_TD_WORD2_0_ADDR A:0x65642508
y.create.l HWIO_GERAN_TD_WORD3_0_ADDR A:0x6564250c
y.create.l HWIO_GERAN_TD_WORD4_0_ADDR A:0x65642510
y.create.l HWIO_GERAN_TD_WORD5_0_ADDR A:0x65642514
y.create.l HWIO_GERAN_TD_WORD6_0_ADDR A:0x65642518
y.create.l HWIO_GERAN_TD_WORD0_1_ADDR A:0x65642600
y.create.l HWIO_GERAN_TD_WORD1_1_ADDR A:0x65642604
y.create.l HWIO_GERAN_TD_WORD2_1_ADDR A:0x65642608
y.create.l HWIO_GERAN_TD_WORD3_1_ADDR A:0x6564260c
y.create.l HWIO_GERAN_TD_WORD4_1_ADDR A:0x65642610
y.create.l HWIO_GERAN_TD_WORD5_1_ADDR A:0x65642614
y.create.l HWIO_GERAN_TD_WORD6_1_ADDR A:0x65642618
y.create.l HWIO_HDR_TD_WORD0_0_ADDR A:0x65642700
y.create.l HWIO_HDR_TD_WORD1_0_ADDR A:0x65642704
y.create.l HWIO_HDR_TD_WORD2_0_ADDR A:0x65642708
y.create.l HWIO_HDR_TD_WORD3_0_ADDR A:0x6564270c
y.create.l HWIO_HDR_TD_WORD4_0_ADDR A:0x65642710
y.create.l HWIO_HDR_TD_WORD5_0_ADDR A:0x65642714
y.create.l HWIO_HDR_TD_WORD0_1_ADDR A:0x65642800
y.create.l HWIO_HDR_TD_WORD1_1_ADDR A:0x65642804
y.create.l HWIO_HDR_TD_WORD2_1_ADDR A:0x65642808
y.create.l HWIO_HDR_TD_WORD3_1_ADDR A:0x6564280c
y.create.l HWIO_HDR_TD_WORD4_1_ADDR A:0x65642810
y.create.l HWIO_HDR_TD_WORD5_1_ADDR A:0x65642814
y.create.l HWIO_TDECIB_MEM_START_ADDR A:0x65643000
y.create.l HWIO_TDECIB_MEM_END_ADDR A:0x65643ffc
y.create.l HWIO_DEMBACK_EN_ADDR A:0x65660000
y.create.l HWIO_DEMBACK_MODE_SEL_ADDR A:0x65660004
y.create.l HWIO_DEMBACK_AHB_ERR_ADDR A:0x65660008
y.create.l HWIO_DEMBACK_MM_RDR0_CFG0_ADDR A:0x65661000
y.create.l HWIO_DEMBACK_MM_RDR1_CFG0_ADDR A:0x6566100c
y.create.l HWIO_DEMBACK_MM_RDR2_CFG0_ADDR A:0x65661018
y.create.l HWIO_DEMBACK_MM_RDR0_CFG1_ADDR A:0x65661004
y.create.l HWIO_DEMBACK_MM_RDR1_CFG1_ADDR A:0x65661010
y.create.l HWIO_DEMBACK_MM_RDR2_CFG1_ADDR A:0x6566101c
y.create.l HWIO_DEMBACK_MM_RDR0_XFER_CTL_ADDR A:0x65661008
y.create.l HWIO_DEMBACK_MM_RDR1_XFER_CTL_ADDR A:0x65661014
y.create.l HWIO_DEMBACK_MM_RDR2_XFER_CTL_ADDR A:0x65661020
y.create.l HWIO_DEMBACK_RDR3_CFG0_ADDR A:0x65661024
y.create.l HWIO_DEMBACK_RDR3_CFG1_ADDR A:0x65661028
y.create.l HWIO_DEMBACK_RDR3_XFER_CTL_ADDR A:0x6566102c
y.create.l HWIO_DEMBACK_NN_RDR0_CFG0_ADDR A:0x65661030
y.create.l HWIO_DEMBACK_NN_RDR1_CFG0_ADDR A:0x6566103c
y.create.l HWIO_DEMBACK_NN_RDR0_CFG1_ADDR A:0x65661034
y.create.l HWIO_DEMBACK_NN_RDR1_CFG1_ADDR A:0x65661040
y.create.l HWIO_DEMBACK_NN_RDR0_XFER_CTL_ADDR A:0x65661038
y.create.l HWIO_DEMBACK_NN_RDR1_XFER_CTL_ADDR A:0x65661044
y.create.l HWIO_DEMBACK_NN_RDR2_CFG0_ADDR A:0x65661048
y.create.l HWIO_DEMBACK_NN_RDR2_CFG1_ADDR A:0x6566104c
y.create.l HWIO_DEMBACK_NN_RDR2_XFER_CTL_ADDR A:0x65661050
y.create.l HWIO_DEMBACK_NN_RDR3_CFG0_ADDR A:0x65661054
y.create.l HWIO_DEMBACK_NN_RDR3_CFG1_ADDR A:0x65661058
y.create.l HWIO_DEMBACK_NN_RDR3_XFER_CTL_ADDR A:0x6566105c
y.create.l HWIO_DEMBACK_WRTR0_CFG0_ADDR A:0x65661060
y.create.l HWIO_DEMBACK_WRTR1_CFG0_ADDR A:0x6566106c
y.create.l HWIO_DEMBACK_WRTR0_CFG1_ADDR A:0x65661064
y.create.l HWIO_DEMBACK_WRTR1_CFG1_ADDR A:0x65661070
y.create.l HWIO_DEMBACK_WRTR0_XFER_CTL_ADDR A:0x65661068
y.create.l HWIO_DEMBACK_WRTR1_XFER_CTL_ADDR A:0x65661074
y.create.l HWIO_DEMBACK_WRTR2_CFG0_ADDR A:0x65661078
y.create.l HWIO_DEMBACK_WRTR2_CFG1_ADDR A:0x6566107c
y.create.l HWIO_DEMBACK_WRTR2_XFER_CTL_ADDR A:0x65661080
y.create.l HWIO_DEMBACK_WRTR3_CFG0_ADDR A:0x65661084
y.create.l HWIO_DEMBACK_WRTR3_CFG1_ADDR A:0x65661088
y.create.l HWIO_DEMBACK_WRTR3_XFER_CTL_ADDR A:0x6566108c
y.create.l HWIO_DEMBACK_BRDG_CTL_ADDR A:0x65661090
y.create.l HWIO_DEMBACK_BRDG_STATUS_ADDR A:0x65661094
y.create.l HWIO_DEMBACK_BRDG_CLEAR_ADDR A:0x65661098
y.create.l HWIO_DEMBACK_DBG_CFG0_ADDR A:0x6566109c
y.create.l HWIO_DEMBACK_DBG_CFG1_ADDR A:0x656610a0
y.create.l HWIO_DEMBACK_DBG_CTL_ADDR A:0x656610a4
y.create.l HWIO_DEMBACK_DBG_MATCH_MASK0_ADDR A:0x656610a8
y.create.l HWIO_DEMBACK_DBG_MATCH_MASK1_ADDR A:0x656610ac
y.create.l HWIO_DEMBACK_DBG_MATCH_PATTERN0_ADDR A:0x656610b0
y.create.l HWIO_DEMBACK_DBG_MATCH_PATTERN1_ADDR A:0x656610b4
y.create.l HWIO_DEMBACK_DBG_TRACE_LEN_ADDR A:0x656610b8
y.create.l HWIO_DEMBACK_DBG_WINDOW_LEN_ADDR A:0x656610bc
y.create.l HWIO_DEMBACK_DBG_TRIGGER_LEN_ADDR A:0x656610c0
y.create.l HWIO_LTE_DBE_PHICH_STATUS_ADDR A:0x65662000
y.create.l HWIO_LTE_DBE_PCFICH_STATUS_ADDR A:0x65662004
y.create.l HWIO_LTE_DBE_SCRAMBLE_SEED_FF_X1_SEED_ADDR A:0x65662008
y.create.l HWIO_LTE_DBE_TESTBUS_ENABLE_ADDR A:0x6566200c
y.create.l HWIO_LTE_DBE_TESTBUS_STATUS_ADDR A:0x65662010
y.create.l HWIO_LTE_DBE_PBCH_CMD_COUNT_ADDR A:0x65662014
y.create.l HWIO_LTE_DBE_PDCCH_CMD_COUNT_ADDR A:0x65662018
y.create.l HWIO_LTE_DBE_PDSCH_CMD_COUNT_ADDR A:0x6566201c
y.create.l HWIO_LTE_DBE_PBCH_DONE_COUNT_ADDR A:0x65662020
y.create.l HWIO_LTE_DBE_PDCCH_DONE_COUNT_ADDR A:0x65662024
y.create.l HWIO_LTE_DBE_PDSCH_DONE_COUNT_ADDR A:0x65662028
y.create.l HWIO_TESTBUS_ENABLE_ADDR A:0x65663000
y.create.l HWIO_TESTBUS_STATUS_ADDR A:0x65663004
y.create.l HWIO_DBACK_AMP_EST0_0_ADDR A:0x65664000
y.create.l HWIO_DBACK_AMP_EST0_1_ADDR A:0x65664008
y.create.l HWIO_DBACK_AMP_EST0_2_ADDR A:0x65664010
y.create.l HWIO_DBACK_AMP_EST0_3_ADDR A:0x65664018
y.create.l HWIO_DBACK_AMP_EST0_4_ADDR A:0x65664020
y.create.l HWIO_DBACK_AMP_EST0_5_ADDR A:0x65664028
y.create.l HWIO_DBACK_ENG_EST0_0_ADDR A:0x65664004
y.create.l HWIO_DBACK_ENG_EST0_1_ADDR A:0x6566400c
y.create.l HWIO_DBACK_ENG_EST0_2_ADDR A:0x65664014
y.create.l HWIO_DBACK_ENG_EST0_3_ADDR A:0x6566401c
y.create.l HWIO_DBACK_ENG_EST0_4_ADDR A:0x65664024
y.create.l HWIO_DBACK_ENG_EST0_5_ADDR A:0x6566402c
y.create.l HWIO_DBACK_AMP_EST1_0_ADDR A:0x65664030
y.create.l HWIO_DBACK_AMP_EST1_1_ADDR A:0x65664038
y.create.l HWIO_DBACK_AMP_EST1_2_ADDR A:0x65664040
y.create.l HWIO_DBACK_AMP_EST1_3_ADDR A:0x65664048
y.create.l HWIO_DBACK_AMP_EST1_4_ADDR A:0x65664050
y.create.l HWIO_DBACK_AMP_EST1_5_ADDR A:0x65664058
y.create.l HWIO_DBACK_ENG_EST1_0_ADDR A:0x65664034
y.create.l HWIO_DBACK_ENG_EST1_1_ADDR A:0x6566403c
y.create.l HWIO_DBACK_ENG_EST1_2_ADDR A:0x65664044
y.create.l HWIO_DBACK_ENG_EST1_3_ADDR A:0x6566404c
y.create.l HWIO_DBACK_ENG_EST1_4_ADDR A:0x65664054
y.create.l HWIO_DBACK_ENG_EST1_5_ADDR A:0x6566405c
y.create.l HWIO_DBACK_HS_CH0_PART1_DEC_DATA0_ADDR A:0x65664060
y.create.l HWIO_DBACK_HS_CH1_PART1_DEC_DATA0_ADDR A:0x6566406c
y.create.l HWIO_DBACK_HS_CH2_PART1_DEC_DATA0_ADDR A:0x65664078
y.create.l HWIO_DBACK_HS_CH3_PART1_DEC_DATA0_ADDR A:0x65664084
y.create.l HWIO_DBACK_HS_CH4_PART1_DEC_DATA0_ADDR A:0x65664090
y.create.l HWIO_DBACK_HS_CH5_PART1_DEC_DATA0_ADDR A:0x6566409c
y.create.l HWIO_DBACK_HS_CH6_PART1_DEC_DATA0_ADDR A:0x656640a8
y.create.l HWIO_DBACK_HS_CH7_PART1_DEC_DATA0_ADDR A:0x656640b4
y.create.l HWIO_DBACK_HS_CH8_PART1_DEC_DATA0_ADDR A:0x656640c0
y.create.l HWIO_DBACK_HS_CH9_PART1_DEC_DATA0_ADDR A:0x656640cc
y.create.l HWIO_DBACK_HS_CH0_PART1_DEC_STAT_ADDR A:0x65664064
y.create.l HWIO_DBACK_HS_CH1_PART1_DEC_STAT_ADDR A:0x65664070
y.create.l HWIO_DBACK_HS_CH2_PART1_DEC_STAT_ADDR A:0x6566407c
y.create.l HWIO_DBACK_HS_CH3_PART1_DEC_STAT_ADDR A:0x65664088
y.create.l HWIO_DBACK_HS_CH4_PART1_DEC_STAT_ADDR A:0x65664094
y.create.l HWIO_DBACK_HS_CH5_PART1_DEC_STAT_ADDR A:0x656640a0
y.create.l HWIO_DBACK_HS_CH6_PART1_DEC_STAT_ADDR A:0x656640ac
y.create.l HWIO_DBACK_HS_CH7_PART1_DEC_STAT_ADDR A:0x656640b8
y.create.l HWIO_DBACK_HS_CH8_PART1_DEC_STAT_ADDR A:0x656640c4
y.create.l HWIO_DBACK_HS_CH9_PART1_DEC_STAT_ADDR A:0x656640d0
y.create.l HWIO_DBACK_HS_CH0_SLOT1_AE_EST_ADDR A:0x65664068
y.create.l HWIO_DBACK_HS_CH1_SLOT1_AE_EST_ADDR A:0x65664074
y.create.l HWIO_DBACK_HS_CH2_SLOT1_AE_EST_ADDR A:0x65664080
y.create.l HWIO_DBACK_HS_CH3_SLOT1_AE_EST_ADDR A:0x6566408c
y.create.l HWIO_DBACK_HS_CH4_SLOT1_AE_EST_ADDR A:0x65664098
y.create.l HWIO_DBACK_HS_CH5_SLOT1_AE_EST_ADDR A:0x656640a4
y.create.l HWIO_DBACK_HS_CH6_SLOT1_AE_EST_ADDR A:0x656640b0
y.create.l HWIO_DBACK_HS_CH7_SLOT1_AE_EST_ADDR A:0x656640bc
y.create.l HWIO_DBACK_HS_CH8_SLOT1_AE_EST_ADDR A:0x656640c8
y.create.l HWIO_DBACK_HS_CH9_SLOT1_AE_EST_ADDR A:0x656640d4
y.create.l HWIO_DBACK_HS_CH0_PART2_DEC_DATA1_ADDR A:0x656640d8
y.create.l HWIO_DBACK_HS_CH1_PART2_DEC_DATA1_ADDR A:0x656640e8
y.create.l HWIO_DBACK_HS_CH2_PART2_DEC_DATA1_ADDR A:0x656640f8
y.create.l HWIO_DBACK_HS_CH3_PART2_DEC_DATA1_ADDR A:0x65664108
y.create.l HWIO_DBACK_HS_CH4_PART2_DEC_DATA1_ADDR A:0x65664118
y.create.l HWIO_DBACK_HS_CH5_PART2_DEC_DATA1_ADDR A:0x65664128
y.create.l HWIO_DBACK_HS_CH6_PART2_DEC_DATA1_ADDR A:0x65664138
y.create.l HWIO_DBACK_HS_CH7_PART2_DEC_DATA1_ADDR A:0x65664148
y.create.l HWIO_DBACK_HS_CH8_PART2_DEC_DATA1_ADDR A:0x65664158
y.create.l HWIO_DBACK_HS_CH9_PART2_DEC_DATA1_ADDR A:0x65664168
y.create.l HWIO_DBACK_HS_CH0_PART2_DEC_STAT_ADDR A:0x656640dc
y.create.l HWIO_DBACK_HS_CH1_PART2_DEC_STAT_ADDR A:0x656640ec
y.create.l HWIO_DBACK_HS_CH2_PART2_DEC_STAT_ADDR A:0x656640fc
y.create.l HWIO_DBACK_HS_CH3_PART2_DEC_STAT_ADDR A:0x6566410c
y.create.l HWIO_DBACK_HS_CH4_PART2_DEC_STAT_ADDR A:0x6566411c
y.create.l HWIO_DBACK_HS_CH5_PART2_DEC_STAT_ADDR A:0x6566412c
y.create.l HWIO_DBACK_HS_CH6_PART2_DEC_STAT_ADDR A:0x6566413c
y.create.l HWIO_DBACK_HS_CH7_PART2_DEC_STAT_ADDR A:0x6566414c
y.create.l HWIO_DBACK_HS_CH8_PART2_DEC_STAT_ADDR A:0x6566415c
y.create.l HWIO_DBACK_HS_CH9_PART2_DEC_STAT_ADDR A:0x6566416c
y.create.l HWIO_DBACK_HS_CH0_SLOT2_AE_EST_ADDR A:0x656640e0
y.create.l HWIO_DBACK_HS_CH1_SLOT2_AE_EST_ADDR A:0x656640f0
y.create.l HWIO_DBACK_HS_CH2_SLOT2_AE_EST_ADDR A:0x65664100
y.create.l HWIO_DBACK_HS_CH3_SLOT2_AE_EST_ADDR A:0x65664110
y.create.l HWIO_DBACK_HS_CH4_SLOT2_AE_EST_ADDR A:0x65664120
y.create.l HWIO_DBACK_HS_CH5_SLOT2_AE_EST_ADDR A:0x65664130
y.create.l HWIO_DBACK_HS_CH6_SLOT2_AE_EST_ADDR A:0x65664140
y.create.l HWIO_DBACK_HS_CH7_SLOT2_AE_EST_ADDR A:0x65664150
y.create.l HWIO_DBACK_HS_CH8_SLOT2_AE_EST_ADDR A:0x65664160
y.create.l HWIO_DBACK_HS_CH9_SLOT2_AE_EST_ADDR A:0x65664170
y.create.l HWIO_DBACK_HS_CH0_SLOT3_AE_EST_ADDR A:0x656640e4
y.create.l HWIO_DBACK_HS_CH1_SLOT3_AE_EST_ADDR A:0x656640f4
y.create.l HWIO_DBACK_HS_CH2_SLOT3_AE_EST_ADDR A:0x65664104
y.create.l HWIO_DBACK_HS_CH3_SLOT3_AE_EST_ADDR A:0x65664114
y.create.l HWIO_DBACK_HS_CH4_SLOT3_AE_EST_ADDR A:0x65664124
y.create.l HWIO_DBACK_HS_CH5_SLOT3_AE_EST_ADDR A:0x65664134
y.create.l HWIO_DBACK_HS_CH6_SLOT3_AE_EST_ADDR A:0x65664144
y.create.l HWIO_DBACK_HS_CH7_SLOT3_AE_EST_ADDR A:0x65664154
y.create.l HWIO_DBACK_HS_CH8_SLOT3_AE_EST_ADDR A:0x65664164
y.create.l HWIO_DBACK_HS_CH9_SLOT3_AE_EST_ADDR A:0x65664174
y.create.l HWIO_DBACK_EAGCH_DEC_DATA_ADDR A:0x65664178
y.create.l HWIO_DBACK_EAGCH_DEC_STAT_ADDR A:0x6566417c
y.create.l HWIO_DBACK_EAGCH_METRIC_ADDR A:0x65664180
y.create.l HWIO_DBACK_HSSCCH_CTL1_ADDR A:0x65664184
y.create.l HWIO_DBACK_HSSCCH_CTL2_ADDR A:0x65664188
y.create.l HWIO_HS_SCCH_PART2_DECODE_MAP_ADDR A:0x6566418c
y.create.l HWIO_DBACK_CH0_UEID_MASK_0_ADDR A:0x65664190
y.create.l HWIO_DBACK_CH1_UEID_MASK_0_ADDR A:0x65664194
y.create.l HWIO_DBACK_CH2_UEID_MASK_0_ADDR A:0x65664198
y.create.l HWIO_DBACK_CH3_UEID_MASK_0_ADDR A:0x6566419c
y.create.l HWIO_DBACK_CH4_UEID_MASK_0_ADDR A:0x656641a0
y.create.l HWIO_DBACK_CH5_UEID_MASK_0_ADDR A:0x656641a4
y.create.l HWIO_DBACK_CH6_UEID_MASK_0_ADDR A:0x656641a8
y.create.l HWIO_DBACK_CH7_UEID_MASK_0_ADDR A:0x656641ac
y.create.l HWIO_DBACK_CH8_UEID_MASK_0_ADDR A:0x656641b0
y.create.l HWIO_DBACK_CH9_UEID_MASK_0_ADDR A:0x656641b4
y.create.l HWIO_DBACK_CH0_UEID_MASK_1_ADDR A:0x656641b8
y.create.l HWIO_DBACK_CH1_UEID_MASK_1_ADDR A:0x656641bc
y.create.l HWIO_DBACK_CH2_UEID_MASK_1_ADDR A:0x656641c0
y.create.l HWIO_DBACK_CH3_UEID_MASK_1_ADDR A:0x656641c4
y.create.l HWIO_DBACK_CH4_UEID_MASK_1_ADDR A:0x656641c8
y.create.l HWIO_DBACK_CH5_UEID_MASK_1_ADDR A:0x656641cc
y.create.l HWIO_DBACK_CH6_UEID_MASK_1_ADDR A:0x656641d0
y.create.l HWIO_DBACK_CH7_UEID_MASK_1_ADDR A:0x656641d4
y.create.l HWIO_DBACK_CH8_UEID_MASK_1_ADDR A:0x656641d8
y.create.l HWIO_DBACK_CH9_UEID_MASK_1_ADDR A:0x656641dc
y.create.l HWIO_DBACK_HSSCCH_PART1_TRIGGER_ADDR A:0x656641e0
y.create.l HWIO_DBACK_HSSCCH_YAM_THRES_ADDR A:0x656641e4
y.create.l HWIO_DBACK_HSSCCH_PART2_TRIGGER_ADDR A:0x656641e8
y.create.l HWIO_DBACK_HSSCCH_STATUS_ADDR A:0x656641ec
y.create.l HWIO_DBACK_EAGCH_CONFIG_ADDR A:0x656641f0
y.create.l HWIO_DBACK_EAGCH_CTL_ADDR A:0x656641f4
y.create.l HWIO_DBACK_EAGCH_TRIGGER_ADDR A:0x656641f8
y.create.l HWIO_DBACK_EAGCH_RM_PATTERN_0_ADDR A:0x656641fc
y.create.l HWIO_DBACK_EAGCH_RM_PATTERN_1_ADDR A:0x65664200
y.create.l HWIO_DBACK_EAGCH_RM_PATTERN_2_ADDR A:0x65664204
y.create.l HWIO_DBACK_HS_EUL_CTL_CH_RST_ADDR A:0x65664208
y.create.l HWIO_DBACK_NONHS_WCB_SIZE_ADDR A:0x6566420c
y.create.l HWIO_DBACK_HS_WCB_SIZE_ADDR A:0x65664210
y.create.l HWIO_DBACK_PART1_INT_STATUS_ADDR A:0x65664214
y.create.l HWIO_DBACK_PART1_INT_CLR_ADDR A:0x65664218
y.create.l HWIO_DBACK_PART1_INT_EN_ADDR A:0x6566421c
y.create.l HWIO_DBACK_PART2_INT_STATUS_ADDR A:0x65664220
y.create.l HWIO_DBACK_PART2_INT_CLR_ADDR A:0x65664224
y.create.l HWIO_DBACK_PART2_INT_EN_ADDR A:0x65664228
y.create.l HWIO_DBACK_EAGCH_INT_EN_ADDR A:0x6566422c
y.create.l HWIO_DBACK_TEST_MEM_SEL_ADDR A:0x65664230
y.create.l HWIO_DBACK_TEST_BUS_SEL_ADDR A:0x65664234
y.create.l HWIO_DBACK_MEM_ADDR_ADDR A:0x65664238
y.create.l HWIO_DBACK_MEM_DATA0_ADDR A:0x6566423c
y.create.l HWIO_DBACK_MEM_DATA1_ADDR A:0x65664240
y.create.l HWIO_DBACK_MEM_DATA2_ADDR A:0x65664244
y.create.l HWIO_DBACK_MEM_DATA3_ADDR A:0x65664248
y.create.l HWIO_DBACK_MEM_DATA4_ADDR A:0x6566424c
y.create.l HWIO_T_DBACK_HS_CH0_DEC_DATA0_ADDR A:0x65665000
y.create.l HWIO_T_DBACK_HS_CH1_DEC_DATA0_ADDR A:0x6566500c
y.create.l HWIO_T_DBACK_HS_CH2_DEC_DATA0_ADDR A:0x65665018
y.create.l HWIO_T_DBACK_HS_CH3_DEC_DATA0_ADDR A:0x65665024
y.create.l HWIO_T_DBACK_HS_CH0_DEC_DATA1_ADDR A:0x65665004
y.create.l HWIO_T_DBACK_HS_CH1_DEC_DATA1_ADDR A:0x65665010
y.create.l HWIO_T_DBACK_HS_CH2_DEC_DATA1_ADDR A:0x6566501c
y.create.l HWIO_T_DBACK_HS_CH3_DEC_DATA1_ADDR A:0x65665028
y.create.l HWIO_T_DBACK_HS_CH0_DEC_STAT_ADDR A:0x65665008
y.create.l HWIO_T_DBACK_HS_CH1_DEC_STAT_ADDR A:0x65665014
y.create.l HWIO_T_DBACK_HS_CH2_DEC_STAT_ADDR A:0x65665020
y.create.l HWIO_T_DBACK_HS_CH3_DEC_STAT_ADDR A:0x6566502c
y.create.l HWIO_T_DBACK_EAGCH0_DEC_DATA0_ADDR A:0x65665030
y.create.l HWIO_T_DBACK_EAGCH1_DEC_DATA0_ADDR A:0x65665040
y.create.l HWIO_T_DBACK_EAGCH2_DEC_DATA0_ADDR A:0x65665050
y.create.l HWIO_T_DBACK_EAGCH3_DEC_DATA0_ADDR A:0x65665060
y.create.l HWIO_T_DBACK_EAGCH0_DEC_DATA1_ADDR A:0x65665034
y.create.l HWIO_T_DBACK_EAGCH1_DEC_DATA1_ADDR A:0x65665044
y.create.l HWIO_T_DBACK_EAGCH2_DEC_DATA1_ADDR A:0x65665054
y.create.l HWIO_T_DBACK_EAGCH3_DEC_DATA1_ADDR A:0x65665064
y.create.l HWIO_T_DBACK_EAGCH0_DEC_STAT_ADDR A:0x65665038
y.create.l HWIO_T_DBACK_EAGCH1_DEC_STAT_ADDR A:0x65665048
y.create.l HWIO_T_DBACK_EAGCH2_DEC_STAT_ADDR A:0x65665058
y.create.l HWIO_T_DBACK_EAGCH3_DEC_STAT_ADDR A:0x65665068
y.create.l HWIO_T_DBACK_EAGCH0_METRIC_ADDR A:0x6566503c
y.create.l HWIO_T_DBACK_EAGCH1_METRIC_ADDR A:0x6566504c
y.create.l HWIO_T_DBACK_EAGCH2_METRIC_ADDR A:0x6566505c
y.create.l HWIO_T_DBACK_EAGCH3_METRIC_ADDR A:0x6566506c
y.create.l HWIO_T_DBACK_FPACH_DEC_DATA0_ADDR A:0x65665070
y.create.l HWIO_T_DBACK_FPACH_DEC_DATA1_ADDR A:0x65665074
y.create.l HWIO_T_DBACK_FPACH_DEC_STAT_ADDR A:0x65665078
y.create.l HWIO_T_DBACK_TEST_MEM_SEL_ADDR A:0x6566507c
y.create.l HWIO_T_DBACK_TEST_BUS_SEL_ADDR A:0x65665080
y.create.l HWIO_T_DBACK_MEM_ADDR_ADDR A:0x65665084
y.create.l HWIO_T_DBACK_MEM_DATA0_ADDR A:0x65665088
y.create.l HWIO_T_DBACK_MEM_DATA1_ADDR A:0x6566508c
y.create.l HWIO_T_DBACK_MEM_DATA2_ADDR A:0x65665090
y.create.l HWIO_T_DBACK_MEM_DATA3_ADDR A:0x65665094
y.create.l HWIO_T_DBACK_MEM_DATA4_ADDR A:0x65665098
y.create.l HWIO_T_DBACK_HS_CH0_DC_DEC_DATA0_ADDR A:0x6566509c
y.create.l HWIO_T_DBACK_HS_CH1_DC_DEC_DATA0_ADDR A:0x656650a8
y.create.l HWIO_T_DBACK_HS_CH2_DC_DEC_DATA0_ADDR A:0x656650b4
y.create.l HWIO_T_DBACK_HS_CH3_DC_DEC_DATA0_ADDR A:0x656650c0
y.create.l HWIO_T_DBACK_HS_CH0_DC_DEC_DATA1_ADDR A:0x656650a0
y.create.l HWIO_T_DBACK_HS_CH1_DC_DEC_DATA1_ADDR A:0x656650ac
y.create.l HWIO_T_DBACK_HS_CH2_DC_DEC_DATA1_ADDR A:0x656650b8
y.create.l HWIO_T_DBACK_HS_CH3_DC_DEC_DATA1_ADDR A:0x656650c4
y.create.l HWIO_T_DBACK_HS_CH0_DC_DEC_STAT_ADDR A:0x656650a4
y.create.l HWIO_T_DBACK_HS_CH1_DC_DEC_STAT_ADDR A:0x656650b0
y.create.l HWIO_T_DBACK_HS_CH2_DC_DEC_STAT_ADDR A:0x656650bc
y.create.l HWIO_T_DBACK_HS_CH3_DC_DEC_STAT_ADDR A:0x656650c8
y.create.l HWIO_DINT_CFG_ADDR A:0x65666000
y.create.l HWIO_DINT_CH0_CFG_ADDR A:0x65666004
y.create.l HWIO_DINT_CH1_CFG_ADDR A:0x65666008
y.create.l HWIO_DINT_CH2_CFG_ADDR A:0x6566600c
y.create.l HWIO_TD_BLOCK_SIZE_ADDR A:0x65666014
y.create.l HWIO_TD_INTLV_CFG_LO_ADDR A:0x65666018
y.create.l HWIO_TD_INTLV_CFG_HI_ADDR A:0x6566601c
y.create.l HWIO_TD_INTLV_SIZE_LO_ADDR A:0x65666020
y.create.l HWIO_TD_PUNCT_LO_ADDR A:0x65666024
y.create.l HWIO_TD_PUNCT_HI_ADDR A:0x65666028
y.create.l HWIO_DINT_PKT_OFFSET_ADDR A:0x65666030
y.create.l HWIO_DINT_PKT_CFG_ADDR A:0x65666034
y.create.l HWIO_DINT_TASK_OFFSET_ADDR A:0x65666038
y.create.l HWIO_DINT_TASK_LIST_ADDR A:0x6566603c
y.create.l HWIO_TST_SYNC_DINT_ADDR A:0x65666040
y.create.l HWIO_TST_CH0_SYMS_ADDR A:0x65666044
y.create.l HWIO_TST_CH1_SYMS_ADDR A:0x65666048
y.create.l HWIO_TST_CH2_SYMS_ADDR A:0x6566604c
y.create.l HWIO_TST_SEL_DINT_ADDR A:0x65666054
y.create.l HWIO_DINT_OTD_CFG_ADDR A:0x65666058
y.create.l HWIO_TST_SYS_TIME_ADDR A:0x65666070
y.create.l HWIO_DEINT_DBG_BUS_CTL_ADDR A:0x65666074
y.create.l HWIO_DEC_CLR_INT_STATUS_ADDR A:0x65666084
y.create.l HWIO_DEINT_CLK_STATUS_ADDR A:0x65666088
y.create.l HWIO_DEC_DONE_INT_STATUS_ADDR A:0x6566608c
y.create.l HWIO_DEINT_TASK_STATUS_ADDR A:0x65666090
y.create.l HWIO_DEINT_FRMHYP_STATUS_ADDR A:0x65666094
y.create.l HWIO_DINT_VD_RD_ADDR_ADDR A:0x65666098
y.create.l HWIO_DINT_FCH_CFG0_ADDR A:0x6566609c
y.create.l HWIO_DINT_FCH_CFG1_ADDR A:0x656660a0
y.create.l HWIO_DINT_FCH_TRIGGER_ADDR A:0x656660a4
y.create.l HWIO_DINT_FCH_WR_BANK_ADDR A:0x656660a8
y.create.l HWIO_DINT_FCH_EGTH_HYP_CFG0_ADDR A:0x656660ac
y.create.l HWIO_DINT_FCH_EGTH_HYP_CFG1_ADDR A:0x656660b0
y.create.l HWIO_DINT_FCH_EGTH_HYP_CFG2_ADDR A:0x656660b4
y.create.l HWIO_DINT_FCH_EGTH_HYP_CFG3_ADDR A:0x656660b8
y.create.l HWIO_DINT_FCH_QRTR_HYP_CFG0_ADDR A:0x656660bc
y.create.l HWIO_DINT_FCH_QRTR_HYP_CFG1_ADDR A:0x656660c0
y.create.l HWIO_DINT_FCH_QRTR_HYP_CFG2_ADDR A:0x656660c4
y.create.l HWIO_DINT_FCH_QRTR_HYP_CFG3_ADDR A:0x656660c8
y.create.l HWIO_DINT_FCH_HALF_HYP_CFG0_ADDR A:0x656660cc
y.create.l HWIO_DINT_FCH_HALF_HYP_CFG1_ADDR A:0x656660d0
y.create.l HWIO_DINT_FCH_HALF_HYP_CFG2_ADDR A:0x656660d4
y.create.l HWIO_DINT_FCH_HALF_HYP_CFG3_ADDR A:0x656660d8
y.create.l HWIO_DINT_FCH_FULL_HYP_CFG0_ADDR A:0x656660dc
y.create.l HWIO_DINT_FCH_FULL_HYP_CFG1_ADDR A:0x656660e0
y.create.l HWIO_DINT_FCH_FULL_HYP_CFG2_ADDR A:0x656660e4
y.create.l HWIO_DINT_FCH_FULL_HYP_CFG3_ADDR A:0x656660e8
y.create.l HWIO_COMB_FUND_SOFT_DEC_IQ_WR_ADDR A:0x65666100
y.create.l HWIO_C_SYNC_TRIG_REG_ADDR A:0x65666104
y.create.l HWIO_CH0_Q_SOFTDEC_ENABLE_ADDR A:0x65666108
y.create.l HWIO_CH1_CONTROL_ADDR A:0x6566610c
y.create.l HWIO_CH2_CONTROL_ADDR A:0x65666110
y.create.l HWIO_CDMA_WIDGET_STATUS0_ADDR A:0x65666114
y.create.l HWIO_RESET_STATUS0_ADDR A:0x65666118
y.create.l HWIO_CDMA_WIDGET_STATUS1_ADDR A:0x6566611c
y.create.l HWIO_RESET_STATUS1_ADDR A:0x65666120
y.create.l HWIO_CDMA_WIDGET_TEST_CTL_ADDR A:0x65666124
y.create.l HWIO_HDR_DINT_STATUS_ADDR A:0x65667024
y.create.l HWIO_HDR_DINT_DGB_BUS_ADDR A:0x65667080
y.create.l HWIO_HDR_DINT_CLK_STATUS_ADDR A:0x65667084
y.create.l HWIO_SVD_TBVD_CLK_STATUS_REG_ADDR A:0x65668000
y.create.l HWIO_SVD_TBVD_HW_IDLE_ADDR A:0x65668004
y.create.l HWIO_SVD_TBVD_TESTBUS_ENABLE_ADDR A:0x65668008
y.create.l HWIO_SVD_MODE_ADDR A:0x6566800c
y.create.l HWIO_SVD_POLY2IJ_ADDR A:0x65668010
y.create.l HWIO_SVD_POLY3IJ_ADDR A:0x65668014
y.create.l HWIO_SVD_POLY3K_ADDR A:0x65668018
y.create.l HWIO_SVD_POLY4IJ_ADDR A:0x6566801c
y.create.l HWIO_SVD_POLY4KL_ADDR A:0x65668020
y.create.l HWIO_SVD_TESTCON_ADDR A:0x65668024
y.create.l HWIO_SVD_TESTOUT_ADDR A:0x65668028
y.create.l HWIO_SVD_TEST_MEM_SEL_ADDR A:0x6566802c
y.create.l HWIO_SVD_TEST_MEM_ADDR_ADDR A:0x65668030
y.create.l HWIO_SVD_TEST_MEM_WRITE_ADDR A:0x65668034
y.create.l HWIO_SVD_TEST_MEM_READ0_ADDR A:0x65668038
y.create.l HWIO_SVD_TEST_MEM_READ1_ADDR A:0x6566803c
y.create.l HWIO_SVD_TEST_MEM_DIN_ADDR A:0x65668040
y.create.l HWIO_TBVD_DEBUG_MEM_CMD_ADDR A:0x65668044
y.create.l HWIO_TBVD_DEBUG_MEM_WR_ADDR A:0x65668048
y.create.l HWIO_TBVD_DEBUG_MEM_RD_ADDR A:0x6566804c
y.create.l HWIO_LTE_DEMBACK_SCH_STATUS_WORD0_ADDR A:0x65669000
y.create.l HWIO_LTE_DEMBACK_SCH_SHARED_WORD0_ADDR A:0x65669100
y.create.l HWIO_LTE_DEMBACK_SCH_SHARED_WORD1_ADDR A:0x65669104
y.create.l HWIO_LTE_DEMBACK_SCH_SHARED_WORD2_ADDR A:0x65669108
y.create.l HWIO_LTE_DEMBACK_SCH_SHARED_WORD3_ADDR A:0x6566910c
y.create.l HWIO_LTE_DEMBACK_SCH_SHARED_WORD4_ADDR A:0x65669110
y.create.l HWIO_LTE_DEMBACK_SCH_SHARED_WORD5_ADDR A:0x65669114
y.create.l HWIO_PDSCH_HARQ_CFG_WORD0_ADDR A:0x65669200
y.create.l HWIO_PDSCH_HARQ_CFG_WORD1_ADDR A:0x65669204
y.create.l HWIO_PDSCH_HARQ_CFG_WORD2_ADDR A:0x65669208
y.create.l HWIO_PDSCH_HARQ_CFG_WORD3_ADDR A:0x6566920c
y.create.l HWIO_PDSCH_HARQ_CFG_WORD4_ADDR A:0x65669210
y.create.l HWIO_PDSCH_HARQ_CFG_WORD5_ADDR A:0x65669214
y.create.l HWIO_PDSCH_HARQ_CFG_WORD6_ADDR A:0x65669218
y.create.l HWIO_PDSCH_HARQ_CFG_WORD7_ADDR A:0x6566921c
y.create.l HWIO_PDSCH_HARQ_CFG_WORD8_ADDR A:0x65669220
y.create.l HWIO_LTE_DEMBACK_CCH_STATUS_WORD0_ADDR A:0x6566a000
y.create.l HWIO_LTE_DEMBACK_CCH_SHARED_WORD0_ADDR A:0x6566a100
y.create.l HWIO_LTE_DEMBACK_CCH_SHARED_WORD1_ADDR A:0x6566a104
y.create.l HWIO_LTE_DEMBACK_CCH_SHARED_WORD2_ADDR A:0x6566a108
y.create.l HWIO_LTE_DEMBACK_CCH_SHARED_WORD3_ADDR A:0x6566a10c
y.create.l HWIO_LTE_DEMBACK_CCH_SHARED_WORD4_ADDR A:0x6566a110
y.create.l HWIO_LTE_DEMBACK_CCH_SHARED_WORD5_ADDR A:0x6566a114
y.create.l HWIO_LTE_DEMBACK_CCH_SHARED_WORD6_ADDR A:0x6566a118
y.create.l HWIO_LTE_DEMBACK_CCH_SHARED_WORD7_ADDR A:0x6566a11c
y.create.l HWIO_PDCCH_DEINT_CFG_WORD0_ADDR A:0x6566a200
y.create.l HWIO_PDCCH_DEINT_CFG_WORD1_ADDR A:0x6566a204
y.create.l HWIO_PDCCH_DEINT_CFG_WORD2_ADDR A:0x6566a208
y.create.l HWIO_SYMBOL0_REG_MAP_0_WORD0_ADDR A:0x6566a300
y.create.l HWIO_SYMBOL0_REG_MAP_0_WORD1_ADDR A:0x6566a304
y.create.l HWIO_SYMBOL0_REG_MAP_0_WORD2_ADDR A:0x6566a308
y.create.l HWIO_SYMBOL0_REG_MAP_0_WORD3_ADDR A:0x6566a30c
y.create.l HWIO_SYMBOL0_REG_MAP_0_WORD4_ADDR A:0x6566a310
y.create.l HWIO_SYMBOL0_REG_MAP_0_WORD5_ADDR A:0x6566a314
y.create.l HWIO_SYMBOL0_REG_MAP_0_WORD6_ADDR A:0x6566a318
y.create.l HWIO_SYMBOL0_REG_MAP_0_WORD7_ADDR A:0x6566a31c
y.create.l HWIO_SYMBOL0_REG_MAP_1_WORD0_ADDR A:0x6566a400
y.create.l HWIO_SYMBOL0_REG_MAP_1_WORD1_ADDR A:0x6566a404
y.create.l HWIO_SYMBOL0_REG_MAP_1_WORD2_ADDR A:0x6566a408
y.create.l HWIO_SYMBOL0_REG_MAP_1_WORD3_ADDR A:0x6566a40c
y.create.l HWIO_SYMBOL0_REG_MAP_1_WORD4_ADDR A:0x6566a410
y.create.l HWIO_SYMBOL0_REG_MAP_1_WORD5_ADDR A:0x6566a414
y.create.l HWIO_SYMBOL0_REG_MAP_1_WORD6_ADDR A:0x6566a418
y.create.l HWIO_SYMBOL0_REG_MAP_1_WORD7_ADDR A:0x6566a41c
y.create.l HWIO_SYMBOL0_REG_MAP_2_WORD0_ADDR A:0x6566a500
y.create.l HWIO_SYMBOL0_REG_MAP_2_WORD1_ADDR A:0x6566a504
y.create.l HWIO_SYMBOL0_REG_MAP_2_WORD2_ADDR A:0x6566a508
y.create.l HWIO_SYMBOL0_REG_MAP_2_WORD3_ADDR A:0x6566a50c
y.create.l HWIO_SYMBOL0_REG_MAP_2_WORD4_ADDR A:0x6566a510
y.create.l HWIO_SYMBOL0_REG_MAP_2_WORD5_ADDR A:0x6566a514
y.create.l HWIO_SYMBOL0_REG_MAP_2_WORD6_ADDR A:0x6566a518
y.create.l HWIO_SYMBOL0_REG_MAP_2_WORD7_ADDR A:0x6566a51c
y.create.l HWIO_SYMBOL1_REG_MAP_0_WORD0_ADDR A:0x6566a600
y.create.l HWIO_SYMBOL1_REG_MAP_0_WORD1_ADDR A:0x6566a604
y.create.l HWIO_SYMBOL1_REG_MAP_0_WORD2_ADDR A:0x6566a608
y.create.l HWIO_SYMBOL1_REG_MAP_0_WORD3_ADDR A:0x6566a60c
y.create.l HWIO_SYMBOL1_REG_MAP_0_WORD4_ADDR A:0x6566a610
y.create.l HWIO_SYMBOL1_REG_MAP_0_WORD5_ADDR A:0x6566a614
y.create.l HWIO_SYMBOL1_REG_MAP_0_WORD6_ADDR A:0x6566a618
y.create.l HWIO_SYMBOL1_REG_MAP_0_WORD7_ADDR A:0x6566a61c
y.create.l HWIO_SYMBOL1_REG_MAP_0_WORD8_ADDR A:0x6566a620
y.create.l HWIO_SYMBOL1_REG_MAP_0_WORD9_ADDR A:0x6566a624
y.create.l HWIO_SYMBOL1_REG_MAP_0_WORD10_ADDR A:0x6566a628
y.create.l HWIO_SYMBOL1_REG_MAP_1_WORD0_ADDR A:0x6566a700
y.create.l HWIO_SYMBOL1_REG_MAP_1_WORD1_ADDR A:0x6566a704
y.create.l HWIO_SYMBOL1_REG_MAP_1_WORD2_ADDR A:0x6566a708
y.create.l HWIO_SYMBOL1_REG_MAP_1_WORD3_ADDR A:0x6566a70c
y.create.l HWIO_SYMBOL1_REG_MAP_1_WORD4_ADDR A:0x6566a710
y.create.l HWIO_SYMBOL1_REG_MAP_1_WORD5_ADDR A:0x6566a714
y.create.l HWIO_SYMBOL1_REG_MAP_1_WORD6_ADDR A:0x6566a718
y.create.l HWIO_SYMBOL1_REG_MAP_1_WORD7_ADDR A:0x6566a71c
y.create.l HWIO_SYMBOL1_REG_MAP_1_WORD8_ADDR A:0x6566a720
y.create.l HWIO_SYMBOL1_REG_MAP_1_WORD9_ADDR A:0x6566a724
y.create.l HWIO_SYMBOL1_REG_MAP_1_WORD10_ADDR A:0x6566a728
y.create.l HWIO_SYMBOL2_REG_MAP_WORD0_ADDR A:0x6566a800
y.create.l HWIO_SYMBOL2_REG_MAP_WORD1_ADDR A:0x6566a804
y.create.l HWIO_SYMBOL2_REG_MAP_WORD2_ADDR A:0x6566a808
y.create.l HWIO_SYMBOL2_REG_MAP_WORD3_ADDR A:0x6566a80c
y.create.l HWIO_SYMBOL2_REG_MAP_WORD4_ADDR A:0x6566a810
y.create.l HWIO_SYMBOL2_REG_MAP_WORD5_ADDR A:0x6566a814
y.create.l HWIO_SYMBOL2_REG_MAP_WORD6_ADDR A:0x6566a818
y.create.l HWIO_SYMBOL2_REG_MAP_WORD7_ADDR A:0x6566a81c
y.create.l HWIO_SYMBOL2_REG_MAP_WORD8_ADDR A:0x6566a820
y.create.l HWIO_SYMBOL2_REG_MAP_WORD9_ADDR A:0x6566a824
y.create.l HWIO_SYMBOL2_REG_MAP_WORD10_ADDR A:0x6566a828
y.create.l HWIO_PBCH_DEINT_CFG_WORD0_ADDR A:0x6566a900
y.create.l HWIO_PBCH_DEINT_CFG_WORD1_ADDR A:0x6566a904
y.create.l HWIO_PBCH_DEINT_CFG_WORD2_ADDR A:0x6566a908
y.create.l HWIO_PBCH_DEINT_CFG_WORD3_ADDR A:0x6566a90c
y.create.l HWIO_PBCH_DEINT_CFG_WORD4_ADDR A:0x6566a910
y.create.l HWIO_PBCH_DEINT_CFG_WORD5_ADDR A:0x6566a914
y.create.l HWIO_PBCH_DEINT_CFG_WORD6_ADDR A:0x6566a918
y.create.l HWIO_PBCH_DEINT_CFG_WORD7_ADDR A:0x6566a91c
y.create.l HWIO_PBCH_DEINT_CFG_WORD8_ADDR A:0x6566a920
y.create.l HWIO_PBCH_DEINT_CFG_WORD9_ADDR A:0x6566a924
y.create.l HWIO_PBCH_DEINT_CFG_WORD10_ADDR A:0x6566a928
y.create.l HWIO_PDCCH_REG_REORDER_WORD0_ADDR A:0x6566aa00
y.create.l HWIO_PDCCH_REG_REORDER_WORD1_ADDR A:0x6566aa04
y.create.l HWIO_PDCCH_REG_REORDER_WORD2_ADDR A:0x6566aa08
y.create.l HWIO_PDCCH_REG_REORDER_WORD3_ADDR A:0x6566aa0c
y.create.l HWIO_PDCCH_REG_REORDER_WORD4_ADDR A:0x6566aa10
y.create.l HWIO_PBCH_FOH_WORD0_ADDR A:0x6566ab00
y.create.l HWIO_PBCH_FOH_WORD1_ADDR A:0x6566ab04
y.create.l HWIO_PBCH_FOH_WORD2_ADDR A:0x6566ab08
y.create.l HWIO_PDSCH_REENC_TB_CFG_WORD0_ADDR A:0x6566b100
y.create.l HWIO_PDSCH_REENC_TB_CFG_WORD1_ADDR A:0x6566b104
y.create.l HWIO_PDSCH_REENC_TB_CFG_WORD2_ADDR A:0x6566b108
y.create.l HWIO_PDSCH_REENC_CB_WORD0_ADDR A:0x6566b200
y.create.l HWIO_PDSCH_REENC_CB_WORD1_ADDR A:0x6566b204
y.create.l HWIO_PDSCH_REENC_CB_WORD2_ADDR A:0x6566b208
y.create.l HWIO_PBCH_REENC_WORD0_ADDR A:0x6566b300
y.create.l HWIO_PBCH_REENC_WORD1_ADDR A:0x6566b304
y.create.l HWIO_PBCH_REENC_WORD2_ADDR A:0x6566b308
y.create.l HWIO_W_DBACK_HS_SHARED_WORD0_ADDR A:0x6566c100
y.create.l HWIO_W_DBACK_HS_SHARED_WORD1_ADDR A:0x6566c104
y.create.l HWIO_W_DBACK_HS_SHARED_WORD2_ADDR A:0x6566c108
y.create.l HWIO_W_DBACK_HS_SHARED_WORD3_ADDR A:0x6566c10c
y.create.l HWIO_W_DBACK_HS_SHARED_WORD4_ADDR A:0x6566c110
y.create.l HWIO_W_DBACK_HS_SHARED_WORD5_ADDR A:0x6566c114
y.create.l HWIO_W_DBACK_HS_SHARED_WORD6_ADDR A:0x6566c118
y.create.l HWIO_W_DBACK_HS_SHARED_WORD7_ADDR A:0x6566c11c
y.create.l HWIO_W_DBACK_HS_SHARED_WORD8_ADDR A:0x6566c120
y.create.l HWIO_W_DBACK_HS_SHARED_WORD9_ADDR A:0x6566c124
y.create.l HWIO_W_DBACK_HS_SHARED_WORD10_ADDR A:0x6566c128
y.create.l HWIO_W_DBACK_HS_SHARED_WORD11_ADDR A:0x6566c12c
y.create.l HWIO_W_DBACK_HS_SHARED_WORD12_ADDR A:0x6566c130
y.create.l HWIO_W_DBACK_HS_SHARED_WORD13_ADDR A:0x6566c134
y.create.l HWIO_W_DBACK_HS_SHARED_WORD14_ADDR A:0x6566c138
y.create.l HWIO_W_DBACK_HS_SHARED_WORD15_ADDR A:0x6566c13c
y.create.l HWIO_W_DBACK_HS_SHARED_WORD16_ADDR A:0x6566c140
y.create.l HWIO_W_DBACK_HS_SHARED_WORD17_ADDR A:0x6566c144
y.create.l HWIO_W_DBACK_HS_SHARED_WORD18_ADDR A:0x6566c148
y.create.l HWIO_W_DBACK_HS_SHARED_WORD19_ADDR A:0x6566c14c
y.create.l HWIO_W_DBACK_HS_SHARED_WORD20_ADDR A:0x6566c150
y.create.l HWIO_W_DBACK_HS_SHARED_WORD21_ADDR A:0x6566c154
y.create.l HWIO_W_DBACK_HS_SHARED_WORD22_ADDR A:0x6566c158
y.create.l HWIO_W_DBACK_HS_SHARED_WORD23_ADDR A:0x6566c15c
y.create.l HWIO_W_DBACK_HS_SHARED_WORD24_ADDR A:0x6566c160
y.create.l HWIO_W_DBACK_HS_SHARED_WORD25_ADDR A:0x6566c164
y.create.l HWIO_W_DBACK_HS_SHARED_WORD26_ADDR A:0x6566c168
y.create.l HWIO_W_DBACK_HS_SHARED_WORD27_ADDR A:0x6566c16c
y.create.l HWIO_W_DBACK_HS_SHARED_WORD28_ADDR A:0x6566c170
y.create.l HWIO_W_DBACK_HS_SHARED_WORD29_ADDR A:0x6566c174
y.create.l HWIO_W_DBACK_HS_SHARED_WORD30_ADDR A:0x6566c178
y.create.l HWIO_W_DBACK_HS_SHARED_WORD31_ADDR A:0x6566c17c
y.create.l HWIO_W_DBACK_HS_SHARED_WORD32_ADDR A:0x6566c180
y.create.l HWIO_W_DBACK_HS_SHARED_WORD33_ADDR A:0x6566c184
y.create.l HWIO_W_DBACK_HS_SHARED_WORD34_ADDR A:0x6566c188
y.create.l HWIO_W_DBACK_HS_SHARED_WORD35_ADDR A:0x6566c18c
y.create.l HWIO_W_DBACK_HS_SHARED_WORD36_ADDR A:0x6566c190
y.create.l HWIO_W_DBACK_HS_SHARED_WORD37_ADDR A:0x6566c194
y.create.l HWIO_W_DBACK_HS_SHARED_WORD38_ADDR A:0x6566c198
y.create.l HWIO_W_DBACK_HS_SHARED_WORD39_ADDR A:0x6566c19c
y.create.l HWIO_W_DBACK_HS_SHARED_WORD40_ADDR A:0x6566c1a0
y.create.l HWIO_W_DBACK_HS_SHARED_WORD41_ADDR A:0x6566c1a4
y.create.l HWIO_W_DBACK_HS_SHARED_WORD42_ADDR A:0x6566c1a8
y.create.l HWIO_W_DBACK_HS_SHARED_WORD43_ADDR A:0x6566c1ac
y.create.l HWIO_W_DBACK_HS_SHARED_WORD44_ADDR A:0x6566c1b0
y.create.l HWIO_W_DBACK_HS_SHARED_WORD45_ADDR A:0x6566c1b4
y.create.l HWIO_W_DBACK_HS_SHARED_WORD46_ADDR A:0x6566c1b8
y.create.l HWIO_W_DBACK_HS_SHARED_WORD47_ADDR A:0x6566c1bc
y.create.l HWIO_W_DBACK_HS_SHARED_WORD48_ADDR A:0x6566c1c0
y.create.l HWIO_W_DBACK_HS_SHARED_WORD49_ADDR A:0x6566c1c4
y.create.l HWIO_W_DBACK_HS_SHARED_WORD50_ADDR A:0x6566c1c8
y.create.l HWIO_W_DBACK_HS_SHARED_WORD51_ADDR A:0x6566c1cc
y.create.l HWIO_W_DBACK_HS_SHARED_WORD52_ADDR A:0x6566c1d0
y.create.l HWIO_W_DBACK_HS_SHARED_WORD53_ADDR A:0x6566c1d4
y.create.l HWIO_W_DBACK_HS_SHARED_WORD54_ADDR A:0x6566c1d8
y.create.l HWIO_W_DBACK_HS_SHARED_WORD55_ADDR A:0x6566c1dc
y.create.l HWIO_W_DBACK_HS_SHARED_WORD56_ADDR A:0x6566c1e0
y.create.l HWIO_W_DBACK_HS_SHARED_WORD57_ADDR A:0x6566c1e4
y.create.l HWIO_W_DBACK_HS_TD_DECIB_WRITER_WORD0_ADDR A:0x6566c200
y.create.l HWIO_W_DBACK_HS_TD_DECIB_WRITER_CFG_WORD0_ADDR A:0x6566c300
y.create.l HWIO_W_DBACK_HS_TD_DECIB_WRITER_CFG_WORD1_ADDR A:0x6566c304
y.create.l HWIO_W_DBACK_HS_TD_DECIB_WRITER_CFG_WORD2_ADDR A:0x6566c308
y.create.l HWIO_W_DBACK_HS_TD_DECIB_WRITER_CFG_WORD3_ADDR A:0x6566c30c
y.create.l HWIO_W_DBACK_HS_TD_DECIB_WRITER_CFG_WORD4_ADDR A:0x6566c310
y.create.l HWIO_W_DBACK_HS_TD_DECIB_WRITER_CFG_WORD5_ADDR A:0x6566c314
y.create.l HWIO_W_DBACK_HS_TD_DECIB_WRITER_CFG_WORD6_ADDR A:0x6566c318
y.create.l HWIO_W_DBACK_HS_TD_DECIB_WRITER_CFG_WORD7_ADDR A:0x6566c31c
y.create.l HWIO_W_DBACK_NONHS_SHARED_WORD0_ADDR A:0x6566d100
y.create.l HWIO_W_DBACK_NONHS_SHARED_WORD1_ADDR A:0x6566d104
y.create.l HWIO_W_DBACK_NONHS_SHARED_WORD2_ADDR A:0x6566d108
y.create.l HWIO_W_DBACK_NONHS_SHARED_WORD3_ADDR A:0x6566d10c
y.create.l HWIO_W_DBACK_NONHS_SHARED_WORD4_ADDR A:0x6566d110
y.create.l HWIO_W_DBACK_NONHS_SHARED_WORD5_ADDR A:0x6566d114
y.create.l HWIO_W_DBACK_NONHS_SHARED_WORD6_ADDR A:0x6566d118
y.create.l HWIO_W_DBACK_NONHS_SHARED_WORD7_ADDR A:0x6566d11c
y.create.l HWIO_W_DBACK_NONHS_DRM_CFG_WORD0_ADDR A:0x6566d200
y.create.l HWIO_W_DBACK_NONHS_DRM_CFG_WORD1_ADDR A:0x6566d204
y.create.l HWIO_W_DBACK_NONHS_DRM_CFG_WORD2_ADDR A:0x6566d208
y.create.l HWIO_W_DBACK_NONHS_DRM_CFG_WORD3_ADDR A:0x6566d20c
y.create.l HWIO_W_DBACK_NONHS_DRM_CFG_WORD4_ADDR A:0x6566d210
y.create.l HWIO_W_DBACK_NONHS_DRM_CFG_WORD5_ADDR A:0x6566d214
y.create.l HWIO_W_DBACK_NONHS_DRM_CFG_WORD6_ADDR A:0x6566d218
y.create.l HWIO_W_DBACK_NONHS_DRM_CFG_WORD7_ADDR A:0x6566d21c
y.create.l HWIO_W_DBACK_NONHS_DRM_CFG_WORD8_ADDR A:0x6566d220
y.create.l HWIO_W_DBACK_NONHS_DRM_CFG_WORD9_ADDR A:0x6566d224
y.create.l HWIO_W_DBACK_NONHS_DRM_CFG_WORD10_ADDR A:0x6566d228
y.create.l HWIO_W_DBACK_NONHS_DRM_CFG_WORD11_ADDR A:0x6566d22c
y.create.l HWIO_W_DBACK_NONHS_DRM_CFG_WORD12_ADDR A:0x6566d230
y.create.l HWIO_W_DBACK_NONHS_DRM_CFG_WORD13_ADDR A:0x6566d234
y.create.l HWIO_W_DBACK_NONHS_DRM_CFG_WORD14_ADDR A:0x6566d238
y.create.l HWIO_W_DBACK_NONHS_DRM_CFG_WORD15_ADDR A:0x6566d23c
y.create.l HWIO_W_DBACK_NONHS_TD_DECIB_WRITER_CFG_WORD0_ADDR A:0x6566d300
y.create.l HWIO_W_DBACK_NONHS_TD_DECIB_WRITER_CFG_WORD1_ADDR A:0x6566d304
y.create.l HWIO_T_DBACK_SHARED_WORD0_ADDR A:0x6566e100
y.create.l HWIO_T_DBACK_SHARED_WORD1_ADDR A:0x6566e104
y.create.l HWIO_T_DBACK_SHARED_WORD2_ADDR A:0x6566e108
y.create.l HWIO_T_DBACK_SHARED_WORD3_ADDR A:0x6566e10c
y.create.l HWIO_T_DBACK_SHARED_WORD4_ADDR A:0x6566e110
y.create.l HWIO_T_DBACK_SHARED_WORD5_ADDR A:0x6566e114
y.create.l HWIO_T_DBACK_SHARED_WORD6_ADDR A:0x6566e118
y.create.l HWIO_T_DBACK_SHARED_WORD7_ADDR A:0x6566e11c
y.create.l HWIO_T_DBACK_SHARED_WORD8_ADDR A:0x6566e120
y.create.l HWIO_T_DBACK_SHARED_WORD9_ADDR A:0x6566e124
y.create.l HWIO_T_DBACK_SHARED_WORD10_ADDR A:0x6566e128
y.create.l HWIO_T_DBACK_SHARED_WORD11_ADDR A:0x6566e12c
y.create.l HWIO_T_DBACK_SHARED_WORD12_ADDR A:0x6566e130
y.create.l HWIO_T_DBACK_SHARED_WORD13_ADDR A:0x6566e134
y.create.l HWIO_T_DBACK_SHARED_WORD14_ADDR A:0x6566e138
y.create.l HWIO_T_DBACK_SHARED_WORD15_ADDR A:0x6566e13c
y.create.l HWIO_T_DBACK_SHARED_WORD16_ADDR A:0x6566e140
y.create.l HWIO_T_DBACK_SHARED_WORD17_ADDR A:0x6566e144
y.create.l HWIO_T_DBACK_SHARED_WORD18_ADDR A:0x6566e148
y.create.l HWIO_T_DBACK_SHARED_WORD19_ADDR A:0x6566e14c
y.create.l HWIO_T_DBACK_SHARED_WORD20_ADDR A:0x6566e150
y.create.l HWIO_T_DBACK_SHARED_WORD21_ADDR A:0x6566e154
y.create.l HWIO_T_DBACK_SHARED_WORD22_ADDR A:0x6566e158
y.create.l HWIO_T_DBACK_SHARED_WORD23_ADDR A:0x6566e15c
y.create.l HWIO_T_DBACK_SHARED_WORD24_ADDR A:0x6566e160
y.create.l HWIO_T_DBACK_SHARED_WORD25_ADDR A:0x6566e164
y.create.l HWIO_T_DBACK_SHARED_WORD26_ADDR A:0x6566e168
y.create.l HWIO_T_DBACK_SHARED_WORD27_ADDR A:0x6566e16c
y.create.l HWIO_T_DBACK_SHARED_WORD28_ADDR A:0x6566e170
y.create.l HWIO_T_DBACK_SHARED_WORD29_ADDR A:0x6566e174
y.create.l HWIO_T_DBACK_SHARED_WORD30_ADDR A:0x6566e178
y.create.l HWIO_T_DBACK_SHARED_WORD31_ADDR A:0x6566e17c
y.create.l HWIO_T_DBACK_SHARED_WORD32_ADDR A:0x6566e180
y.create.l HWIO_T_DBACK_SHARED_WORD33_ADDR A:0x6566e184
y.create.l HWIO_T_DBACK_SHARED_WORD34_ADDR A:0x6566e188
y.create.l HWIO_T_DBACK_SHARED_WORD35_ADDR A:0x6566e18c
y.create.l HWIO_T_DBACK_SHARED_WORD36_ADDR A:0x6566e190
y.create.l HWIO_T_DBACK_SHARED_WORD37_ADDR A:0x6566e194
y.create.l HWIO_T_DBACK_SHARED_WORD38_ADDR A:0x6566e198
y.create.l HWIO_T_DBACK_NONHS_DRM_CFG_WORD0_ADDR A:0x6566e200
y.create.l HWIO_T_DBACK_NONHS_DRM_CFG_WORD1_ADDR A:0x6566e204
y.create.l HWIO_T_DBACK_NONHS_DRM_CFG_WORD2_ADDR A:0x6566e208
y.create.l HWIO_T_DBACK_NONHS_DRM_CFG_WORD3_ADDR A:0x6566e20c
y.create.l HWIO_T_DBACK_NONHS_DRM_CFG_WORD4_ADDR A:0x6566e210
y.create.l HWIO_T_DBACK_NONHS_DRM_CFG_WORD5_ADDR A:0x6566e214
y.create.l HWIO_T_DBACK_NONHS_DRM_CFG_WORD6_ADDR A:0x6566e218
y.create.l HWIO_T_DBACK_NONHS_DRM_CFG_WORD7_ADDR A:0x6566e21c
y.create.l HWIO_T_DBACK_NONHS_DRM_CFG_WORD8_ADDR A:0x6566e220
y.create.l HWIO_T_DBACK_NONHS_DRM_CFG_WORD9_ADDR A:0x6566e224
y.create.l HWIO_T_DBACK_NONHS_DRM_CFG_WORD10_ADDR A:0x6566e228
y.create.l HWIO_T_DBACK_NONHS_DRM_CFG_WORD11_ADDR A:0x6566e22c
y.create.l HWIO_T_DBACK_NONHS_DRM_CFG_WORD12_ADDR A:0x6566e230
y.create.l HWIO_T_DBACK_NONHS_DRM_CFG_WORD13_ADDR A:0x6566e234
y.create.l HWIO_T_DBACK_NONHS_DRM_CFG_WORD14_ADDR A:0x6566e238
y.create.l HWIO_T_DBACK_NONHS_DRM_CFG_WORD15_ADDR A:0x6566e23c
y.create.l HWIO_T_DBACK_NONHS_DRM_CFG_WORD16_ADDR A:0x6566e240
y.create.l HWIO_T_DBACK_NONHS_DRM_CFG_WORD17_ADDR A:0x6566e244
y.create.l HWIO_T_DBACK_NONHS_DRM_CFG_WORD18_ADDR A:0x6566e248
y.create.l HWIO_T_DBACK_NONHS_DRM_CFG_WORD19_ADDR A:0x6566e24c
y.create.l HWIO_T_DBACK_NONHS_DRM_CFG_WORD20_ADDR A:0x6566e250
y.create.l HWIO_T_DBACK_NONHS_DRM_CFG_WORD21_ADDR A:0x6566e254
y.create.l HWIO_T_DBACK_NONHS_DRM_CFG_WORD22_ADDR A:0x6566e258
y.create.l HWIO_T_DBACK_NONHS_DRM_CFG_WORD23_ADDR A:0x6566e25c
y.create.l HWIO_T_DBACK_NONHS_DRM_CFG_WORD24_ADDR A:0x6566e260
y.create.l HWIO_T_DBACK_NONHS_DRM_CFG_WORD25_ADDR A:0x6566e264
y.create.l HWIO_T_DBACK_NONHS_TD_DECIB_WRITER_CFG_WORD0_ADDR A:0x6566e300
y.create.l HWIO_T_DBACK_NONHS_TD_DECIB_WRITER_CFG_WORD1_ADDR A:0x6566e304
y.create.l HWIO_T_DBACK_HS_TD_DECIB_WRITER_CFG_WORD0_ADDR A:0x6566e400
y.create.l HWIO_T_DBACK_HS_TD_DECIB_WRITER_CFG_WORD1_ADDR A:0x6566e404
y.create.l HWIO_T_DBACK_HS_TD_DECIB_WRITER_CFG_WORD2_ADDR A:0x6566e408
y.create.l HWIO_T_DBACK_HS_TD_DECIB_WRITER_CFG_WORD3_ADDR A:0x6566e40c
y.create.l HWIO_T_DBACK_HS_TD_DECIB_WRITER_CFG_WORD4_ADDR A:0x6566e410
y.create.l HWIO_T_DBACK_HS_TD_DECIB_WRITER_CFG_WORD5_ADDR A:0x6566e414
y.create.l HWIO_T_DBACK_HS_TD_DECIB_WRITER_CFG_WORD6_ADDR A:0x6566e418
y.create.l HWIO_T_DBACK_HS_TD_DECIB_WRITER_CFG_WORD7_ADDR A:0x6566e41c
y.create.l HWIO_HDR_DEINT_CFG_WORD0_ADDR A:0x6566f100
y.create.l HWIO_HDR_DEINT_CFG_WORD1_ADDR A:0x6566f104
y.create.l HWIO_HDR_DEINT_CFG_WORD2_ADDR A:0x6566f108
y.create.l HWIO_HDR_DEINT_CFG_WORD3_ADDR A:0x6566f10c
y.create.l HWIO_HDR_DEINT_CFG_WORD4_ADDR A:0x6566f110
y.create.l HWIO_HDR_DEINT_CFG_WORD5_ADDR A:0x6566f114
y.create.l HWIO_HDR_DEINT_CFG_WORD6_ADDR A:0x6566f118
y.create.l HWIO_HDR_DEINT_CFG_WORD7_ADDR A:0x6566f11c
y.create.l HWIO_HDR_DEINT_CFG_WORD8_ADDR A:0x6566f120
y.create.l HWIO_HDR_DEINT_CFG_WORD9_ADDR A:0x6566f124
y.create.l HWIO_HDR_DEINT_CFG_WORD10_ADDR A:0x6566f128
y.create.l HWIO_HDR_DEINT_CFG_WORD11_ADDR A:0x6566f12c
y.create.l HWIO_HDR_DEINT_CFG_WORD12_ADDR A:0x6566f130
y.create.l HWIO_HDR_DEINT_CFG_WORD13_ADDR A:0x6566f134
y.create.l HWIO_HDR_DEINT_CFG_WORD14_ADDR A:0x6566f138
y.create.l HWIO_HDR_DEINT_CFG_WORD15_ADDR A:0x6566f13c
y.create.l HWIO_HDR_DEINT_CFG_WORD16_ADDR A:0x6566f140
y.create.l HWIO_HDR_DEINT_WORD0_ADDR A:0x6566f200
y.create.l HWIO_HDR_DEINT_WORD1_ADDR A:0x6566f204
y.create.l HWIO_HDR_DEINT_WORD2_ADDR A:0x6566f208
y.create.l HWIO_HDR_DEINT_WORD3_ADDR A:0x6566f20c
y.create.l HWIO_HDR_DEINT_WORD4_ADDR A:0x6566f210
y.create.l HWIO_HDR_DEINT_WORD5_ADDR A:0x6566f214
y.create.l HWIO_HDR_DEINT_WORD6_ADDR A:0x6566f218
y.create.l HWIO_HDR_DEINT_WORD7_ADDR A:0x6566f21c
y.create.l HWIO_HDR_DEINT_WORD8_ADDR A:0x6566f220
y.create.l HWIO_HDR_DEINT_WORD9_ADDR A:0x6566f224
y.create.l HWIO_HDR_DEINT_WORD10_ADDR A:0x6566f228
y.create.l HWIO_HDR_DEINT_WORD11_ADDR A:0x6566f22c
y.create.l HWIO_HDR_DEINT_WORD12_ADDR A:0x6566f230
y.create.l HWIO_HDR_DEINT_WORD13_ADDR A:0x6566f234
y.create.l HWIO_TBVD_CCH_STATUS_WORD0_ADDR A:0x65670000
y.create.l HWIO_TBVD_CCH_LTE_CFG_WORD0_ADDR A:0x65670100
y.create.l HWIO_TBVD_CCH_LTE_CFG_WORD1_ADDR A:0x65670104
y.create.l HWIO_TBVD_CCH_LTE_CFG_WORD2_ADDR A:0x65670108
y.create.l HWIO_TBVD_CCH_LTE_CFG_WORD3_ADDR A:0x6567010c
y.create.l HWIO_TBVD_CCH_LTE_CFG_WORD4_ADDR A:0x65670110
y.create.l HWIO_TBVD_CCH_LTE_CFG_WORD5_ADDR A:0x65670114
y.create.l HWIO_TBVD_CCH_LTE_CFG_WORD6_ADDR A:0x65670118
y.create.l HWIO_TBVD_CCH_LTE_CFG_WORD7_ADDR A:0x6567011c
y.create.l HWIO_TBVD_CCH_LTE_CFG_WORD8_ADDR A:0x65670120
y.create.l HWIO_TBVD_CCH_LTE_CFG_WORD9_ADDR A:0x65670124
y.create.l HWIO_TBVD_CCH_LTE_CFG_WORD10_ADDR A:0x65670128
y.create.l HWIO_TBVD_CCH_LTE_CFG_WORD11_ADDR A:0x6567012c
y.create.l HWIO_TBVD_CCH_LTE_CFG_WORD12_ADDR A:0x65670130
y.create.l HWIO_TBVD_CCH_LTE_CFG_WORD13_ADDR A:0x65670134
y.create.l HWIO_TBVD_CCH_LTE_CFG_WORD14_ADDR A:0x65670138
y.create.l HWIO_TBVD_CCH_LTE_CFG_WORD15_ADDR A:0x6567013c
y.create.l HWIO_TBVD_CCH_LTE_CFG_WORD16_ADDR A:0x65670140
y.create.l HWIO_TBVD_CCH_LTE_CFG_WORD17_ADDR A:0x65670144
y.create.l HWIO_TBVD_CCH_LTE_CFG_WORD18_ADDR A:0x65670148
y.create.l HWIO_TBVD_CCH_LTE_CFG_WORD19_ADDR A:0x6567014c
y.create.l HWIO_TBVD_CCH_LTE_PDCCH_WORD0_ADDR A:0x65670200
y.create.l HWIO_TBVD_CCH_LTE_PDCCH_WORD1_ADDR A:0x65670204
y.create.l HWIO_TBVD_CCH_LTE_PDCCH_WORD2_ADDR A:0x65670208
y.create.l HWIO_TBVD_CCH_LTE_PDCCH_WORD3_ADDR A:0x6567020c
y.create.l HWIO_TBVD_CCH_LTE_PDCCH_WORD4_ADDR A:0x65670210
y.create.l HWIO_TBVD_CCH_LTE_PDCCH_WORD5_ADDR A:0x65670214
y.create.l HWIO_TBVD_CCH_LTE_PDCCH_WORD6_ADDR A:0x65670218
y.create.l HWIO_DEC_O_CCH_W_NONHS_LTE_PBCH_WORD0_ADDR A:0x65670300
y.create.l HWIO_DEC_O_CCH_W_NONHS_LTE_PBCH_WORD1_ADDR A:0x65670304
y.create.l HWIO_DEC_O_CCH_W_NONHS_LTE_PBCH_WORD2_ADDR A:0x65670308
y.create.l HWIO_DEMBACK_ENABLE_ADDR A:0x65674000
y.create.l HWIO_DEMBACK_BUFF_MODE_ADDR A:0x65674004
y.create.l HWIO_DEMBACK_BUFF_MEM_CMD_ADDR A:0x65674010
y.create.l HWIO_DEMBACK_BUFF_MEM_WR_ADDR A:0x65674014
y.create.l HWIO_DEMBACK_BUFF_MEM_RD_ADDR A:0x65674018
y.create.l HWIO_DEMBACK_BUFF_TBVD_DECOB_RD_MIN_ADDR A:0x65675000
y.create.l HWIO_DEMBACK_BUFF_TBVD_DECOB_RD_MAX_ADDR A:0x6567577c
y.create.l HWIO_DEMBACK_BUFF_SVD_DECOB_RD_MIN_ADDR A:0x65676000
y.create.l HWIO_DEMBACK_BUFF_SVD_DECOB_RD_MAX_ADDR A:0x65676d7c
y.create.l HWIO_TDEC_CLK_CTL_DB1_ADDR A:0x65680000
y.create.l HWIO_TDEC_SW_CLK_EN_DB1_ADDR A:0x65680004
y.create.l HWIO_TDEC_CLK_STATUS_REG_DB1_ADDR A:0x65680008
y.create.l HWIO_TDEC_MODE_CTL_DB1_ADDR A:0x6568000c
y.create.l HWIO_TDECIB_CLK_CTL_DB1_ADDR A:0x65680010
y.create.l HWIO_TDECIB_SW_CLK_EN_DB1_ADDR A:0x65680014
y.create.l HWIO_TDECIB_CLK_STATUS_DB1_ADDR A:0x65680018
y.create.l HWIO_TD_COMMON_CFG0_DB1_ADDR A:0x65680020
y.create.l HWIO_TD_COMMON_CFG1_DB1_ADDR A:0x65680024
y.create.l HWIO_TD_COMMON_CFG2_DB1_ADDR A:0x65680028
y.create.l HWIO_TD_COMMON_CFG3_DB1_ADDR A:0x6568002c
y.create.l HWIO_TD_COMMON_CFG4_DB1_ADDR A:0x65680030
y.create.l HWIO_TD_COMMON_CFG5_DB1_ADDR A:0x65680034
y.create.l HWIO_TD_COMMON_START_DB1_ADDR A:0x65680038
y.create.l HWIO_TD_1X_CFG_DB1_ADDR A:0x6568003c
y.create.l HWIO_TD_1X_DECOB_WRITE_PTR_DB1_ADDR A:0x65680040
y.create.l HWIO_TDEC_HW_IDLE_DB1_ADDR A:0x65680044
y.create.l HWIO_TDEC_PING_STATUS_0_DB1_ADDR A:0x65680048
y.create.l HWIO_TDEC_PING_STATUS_1_DB1_ADDR A:0x6568004c
y.create.l HWIO_TDEC_PONG_STATUS_0_DB1_ADDR A:0x65680050
y.create.l HWIO_TDEC_PONG_STATUS_1_DB1_ADDR A:0x65680054
y.create.l HWIO_TDEC_GERAN_STATUS_0_DB1_ADDR A:0x65680058
y.create.l HWIO_TDEC_GERAN_STATUS_1_DB1_ADDR A:0x6568005c
y.create.l HWIO_TDEC_TESTBUS_ENABLE_DB1_ADDR A:0x65680060
y.create.l HWIO_TDEC_TESTBUS_STATUS_DB1_ADDR A:0x65680064
y.create.l HWIO_DECIB_PAGE_ID_DB1_ADDR A:0x65680068
y.create.l HWIO_TDEC_AHB_ERROR_ADDR_RD_DB1_ADDR A:0x65680070
y.create.l HWIO_TEST_CRC_000_RD_DB1_ADDR A:0x65680074
y.create.l HWIO_TEST_CRC_001_RD_DB1_ADDR A:0x65680078
y.create.l HWIO_TEST_CRC_010_RD_DB1_ADDR A:0x6568007c
y.create.l HWIO_TEST_CRC_011_RD_DB1_ADDR A:0x65680080
y.create.l HWIO_TEST_CRC_100_RD_DB1_ADDR A:0x65680084
y.create.l HWIO_TEST_CRC_101_RD_DB1_ADDR A:0x65680088
y.create.l HWIO_TEST_CRC_110_RD_DB1_ADDR A:0x6568008c
y.create.l HWIO_TEST_CRC_111_RD_DB1_ADDR A:0x65680090
y.create.l HWIO_A2_TEST_SW_CFG_DATA0_DB1_ADDR A:0x65680094
y.create.l HWIO_A2_TEST_SW_CFG_DATA1_DB1_ADDR A:0x65680098
y.create.l HWIO_A2_TEST_SW_CFG_DATA2_DB1_ADDR A:0x6568009c
y.create.l HWIO_A2_TEST_SW_CFG_DATA3_DB1_ADDR A:0x656800a0
y.create.l HWIO_A2_TEST_SW_CFG_DATA4_DB1_ADDR A:0x656800a4
y.create.l HWIO_TD_CFG_STATUS_WORD0_DB1_ADDR A:0x65681000
y.create.l HWIO_LTE_CFG_WORD0_DB1_ADDR A:0x65681100
y.create.l HWIO_LTE_CFG_WORD1_DB1_ADDR A:0x65681104
y.create.l HWIO_LTE_CFG_WORD2_DB1_ADDR A:0x65681108
y.create.l HWIO_W_TD_CFG_WORD0_0_DB1_ADDR A:0x65681200
y.create.l HWIO_W_TD_CFG_WORD1_0_DB1_ADDR A:0x65681204
y.create.l HWIO_W_TD_CFG_WORD2_0_DB1_ADDR A:0x65681208
y.create.l HWIO_W_TD_CFG_WORD3_0_DB1_ADDR A:0x6568120c
y.create.l HWIO_W_TD_CFG_WORD4_0_DB1_ADDR A:0x65681210
y.create.l HWIO_W_TD_CFG_WORD5_0_DB1_ADDR A:0x65681214
y.create.l HWIO_W_TD_CFG_WORD6_0_DB1_ADDR A:0x65681218
y.create.l HWIO_W_TD_CFG_WORD7_0_DB1_ADDR A:0x6568121c
y.create.l HWIO_W_TD_CFG_WORD8_0_DB1_ADDR A:0x65681220
y.create.l HWIO_W_TD_CFG_WORD9_0_DB1_ADDR A:0x65681224
y.create.l HWIO_W_TD_CFG_WORD0_1_DB1_ADDR A:0x65681300
y.create.l HWIO_W_TD_CFG_WORD1_1_DB1_ADDR A:0x65681304
y.create.l HWIO_W_TD_CFG_WORD2_1_DB1_ADDR A:0x65681308
y.create.l HWIO_W_TD_CFG_WORD3_1_DB1_ADDR A:0x6568130c
y.create.l HWIO_W_TD_CFG_WORD4_1_DB1_ADDR A:0x65681310
y.create.l HWIO_W_TD_CFG_WORD5_1_DB1_ADDR A:0x65681314
y.create.l HWIO_W_TD_CFG_WORD6_1_DB1_ADDR A:0x65681318
y.create.l HWIO_W_TD_CFG_WORD7_1_DB1_ADDR A:0x6568131c
y.create.l HWIO_W_TD_CFG_WORD8_1_DB1_ADDR A:0x65681320
y.create.l HWIO_W_TD_CFG_WORD9_1_DB1_ADDR A:0x65681324
y.create.l HWIO_LTE_TRBLK_CFG_WORD0_0_DB1_ADDR A:0x65681400
y.create.l HWIO_LTE_TRBLK_CFG_WORD1_0_DB1_ADDR A:0x65681404
y.create.l HWIO_LTE_TRBLK_CFG_WORD2_0_DB1_ADDR A:0x65681408
y.create.l HWIO_LTE_TRBLK_CFG_WORD3_0_DB1_ADDR A:0x6568140c
y.create.l HWIO_LTE_TRBLK_CFG_WORD4_0_DB1_ADDR A:0x65681410
y.create.l HWIO_LTE_TRBLK_CFG_WORD5_0_DB1_ADDR A:0x65681414
y.create.l HWIO_LTE_TRBLK_CFG_WORD0_1_DB1_ADDR A:0x65681500
y.create.l HWIO_LTE_TRBLK_CFG_WORD1_1_DB1_ADDR A:0x65681504
y.create.l HWIO_LTE_TRBLK_CFG_WORD2_1_DB1_ADDR A:0x65681508
y.create.l HWIO_LTE_TRBLK_CFG_WORD3_1_DB1_ADDR A:0x6568150c
y.create.l HWIO_LTE_TRBLK_CFG_WORD4_1_DB1_ADDR A:0x65681510
y.create.l HWIO_LTE_TRBLK_CFG_WORD5_1_DB1_ADDR A:0x65681514
y.create.l HWIO_GERAN_TD_CFG_WORD0_0_DB1_ADDR A:0x65681600
y.create.l HWIO_GERAN_TD_CFG_WORD1_0_DB1_ADDR A:0x65681604
y.create.l HWIO_GERAN_TD_CFG_WORD2_0_DB1_ADDR A:0x65681608
y.create.l HWIO_GERAN_TD_CFG_WORD3_0_DB1_ADDR A:0x6568160c
y.create.l HWIO_GERAN_TD_CFG_WORD0_1_DB1_ADDR A:0x65681700
y.create.l HWIO_GERAN_TD_CFG_WORD1_1_DB1_ADDR A:0x65681704
y.create.l HWIO_GERAN_TD_CFG_WORD2_1_DB1_ADDR A:0x65681708
y.create.l HWIO_GERAN_TD_CFG_WORD3_1_DB1_ADDR A:0x6568170c
y.create.l HWIO_HDR_TD_CFG_WORD0_0_DB1_ADDR A:0x65681800
y.create.l HWIO_HDR_TD_CFG_WORD1_0_DB1_ADDR A:0x65681804
y.create.l HWIO_HDR_TD_CFG_WORD2_0_DB1_ADDR A:0x65681808
y.create.l HWIO_HDR_TD_CFG_WORD0_1_DB1_ADDR A:0x65681900
y.create.l HWIO_HDR_TD_CFG_WORD1_1_DB1_ADDR A:0x65681904
y.create.l HWIO_HDR_TD_CFG_WORD2_1_DB1_ADDR A:0x65681908
y.create.l HWIO_TD_STATUS_WORD0_DB1_ADDR A:0x65682000
y.create.l HWIO_W_TD_WORD0_0_DB1_ADDR A:0x65682100
y.create.l HWIO_W_TD_WORD0_1_DB1_ADDR A:0x65682200
y.create.l HWIO_LTE_PDSCH_WORD0_0_DB1_ADDR A:0x65682300
y.create.l HWIO_LTE_PDSCH_WORD1_0_DB1_ADDR A:0x65682304
y.create.l HWIO_LTE_PDSCH_WORD2_0_DB1_ADDR A:0x65682308
y.create.l HWIO_LTE_PDSCH_WORD0_1_DB1_ADDR A:0x65682400
y.create.l HWIO_LTE_PDSCH_WORD1_1_DB1_ADDR A:0x65682404
y.create.l HWIO_LTE_PDSCH_WORD2_1_DB1_ADDR A:0x65682408
y.create.l HWIO_GERAN_TD_WORD0_0_DB1_ADDR A:0x65682500
y.create.l HWIO_GERAN_TD_WORD1_0_DB1_ADDR A:0x65682504
y.create.l HWIO_GERAN_TD_WORD2_0_DB1_ADDR A:0x65682508
y.create.l HWIO_GERAN_TD_WORD3_0_DB1_ADDR A:0x6568250c
y.create.l HWIO_GERAN_TD_WORD4_0_DB1_ADDR A:0x65682510
y.create.l HWIO_GERAN_TD_WORD5_0_DB1_ADDR A:0x65682514
y.create.l HWIO_GERAN_TD_WORD6_0_DB1_ADDR A:0x65682518
y.create.l HWIO_GERAN_TD_WORD0_1_DB1_ADDR A:0x65682600
y.create.l HWIO_GERAN_TD_WORD1_1_DB1_ADDR A:0x65682604
y.create.l HWIO_GERAN_TD_WORD2_1_DB1_ADDR A:0x65682608
y.create.l HWIO_GERAN_TD_WORD3_1_DB1_ADDR A:0x6568260c
y.create.l HWIO_GERAN_TD_WORD4_1_DB1_ADDR A:0x65682610
y.create.l HWIO_GERAN_TD_WORD5_1_DB1_ADDR A:0x65682614
y.create.l HWIO_GERAN_TD_WORD6_1_DB1_ADDR A:0x65682618
y.create.l HWIO_HDR_TD_WORD0_0_DB1_ADDR A:0x65682700
y.create.l HWIO_HDR_TD_WORD1_0_DB1_ADDR A:0x65682704
y.create.l HWIO_HDR_TD_WORD2_0_DB1_ADDR A:0x65682708
y.create.l HWIO_HDR_TD_WORD3_0_DB1_ADDR A:0x6568270c
y.create.l HWIO_HDR_TD_WORD4_0_DB1_ADDR A:0x65682710
y.create.l HWIO_HDR_TD_WORD5_0_DB1_ADDR A:0x65682714
y.create.l HWIO_HDR_TD_WORD0_1_DB1_ADDR A:0x65682800
y.create.l HWIO_HDR_TD_WORD1_1_DB1_ADDR A:0x65682804
y.create.l HWIO_HDR_TD_WORD2_1_DB1_ADDR A:0x65682808
y.create.l HWIO_HDR_TD_WORD3_1_DB1_ADDR A:0x6568280c
y.create.l HWIO_HDR_TD_WORD4_1_DB1_ADDR A:0x65682810
y.create.l HWIO_HDR_TD_WORD5_1_DB1_ADDR A:0x65682814
y.create.l HWIO_TDECIB_MEM_START_DB1_ADDR A:0x65683000
y.create.l HWIO_TDECIB_MEM_END_DB1_ADDR A:0x65683ffc
y.create.l HWIO_DEMBACK_EN_DB1_ADDR A:0x656a0000
y.create.l HWIO_DEMBACK_MODE_SEL_DB1_ADDR A:0x656a0004
y.create.l HWIO_DEMBACK_AHB_ERR_DB1_ADDR A:0x656a0008
y.create.l HWIO_DEMBACK_MM_RDR0_CFG0_DB1_ADDR A:0x656a1000
y.create.l HWIO_DEMBACK_MM_RDR1_CFG0_DB1_ADDR A:0x656a100c
y.create.l HWIO_DEMBACK_MM_RDR2_CFG0_DB1_ADDR A:0x656a1018
y.create.l HWIO_DEMBACK_MM_RDR0_CFG1_DB1_ADDR A:0x656a1004
y.create.l HWIO_DEMBACK_MM_RDR1_CFG1_DB1_ADDR A:0x656a1010
y.create.l HWIO_DEMBACK_MM_RDR2_CFG1_DB1_ADDR A:0x656a101c
y.create.l HWIO_DEMBACK_MM_RDR0_XFER_CTL_DB1_ADDR A:0x656a1008
y.create.l HWIO_DEMBACK_MM_RDR1_XFER_CTL_DB1_ADDR A:0x656a1014
y.create.l HWIO_DEMBACK_MM_RDR2_XFER_CTL_DB1_ADDR A:0x656a1020
y.create.l HWIO_DEMBACK_RDR3_CFG0_DB1_ADDR A:0x656a1024
y.create.l HWIO_DEMBACK_RDR3_CFG1_DB1_ADDR A:0x656a1028
y.create.l HWIO_DEMBACK_RDR3_XFER_CTL_DB1_ADDR A:0x656a102c
y.create.l HWIO_DEMBACK_NN_RDR0_CFG0_DB1_ADDR A:0x656a1030
y.create.l HWIO_DEMBACK_NN_RDR1_CFG0_DB1_ADDR A:0x656a103c
y.create.l HWIO_DEMBACK_NN_RDR0_CFG1_DB1_ADDR A:0x656a1034
y.create.l HWIO_DEMBACK_NN_RDR1_CFG1_DB1_ADDR A:0x656a1040
y.create.l HWIO_DEMBACK_NN_RDR0_XFER_CTL_DB1_ADDR A:0x656a1038
y.create.l HWIO_DEMBACK_NN_RDR1_XFER_CTL_DB1_ADDR A:0x656a1044
y.create.l HWIO_DEMBACK_NN_RDR2_CFG0_DB1_ADDR A:0x656a1048
y.create.l HWIO_DEMBACK_NN_RDR2_CFG1_DB1_ADDR A:0x656a104c
y.create.l HWIO_DEMBACK_NN_RDR2_XFER_CTL_DB1_ADDR A:0x656a1050
y.create.l HWIO_DEMBACK_NN_RDR3_CFG0_DB1_ADDR A:0x656a1054
y.create.l HWIO_DEMBACK_NN_RDR3_CFG1_DB1_ADDR A:0x656a1058
y.create.l HWIO_DEMBACK_NN_RDR3_XFER_CTL_DB1_ADDR A:0x656a105c
y.create.l HWIO_DEMBACK_WRTR0_CFG0_DB1_ADDR A:0x656a1060
y.create.l HWIO_DEMBACK_WRTR1_CFG0_DB1_ADDR A:0x656a106c
y.create.l HWIO_DEMBACK_WRTR0_CFG1_DB1_ADDR A:0x656a1064
y.create.l HWIO_DEMBACK_WRTR1_CFG1_DB1_ADDR A:0x656a1070
y.create.l HWIO_DEMBACK_WRTR0_XFER_CTL_DB1_ADDR A:0x656a1068
y.create.l HWIO_DEMBACK_WRTR1_XFER_CTL_DB1_ADDR A:0x656a1074
y.create.l HWIO_DEMBACK_WRTR2_CFG0_DB1_ADDR A:0x656a1078
y.create.l HWIO_DEMBACK_WRTR2_CFG1_DB1_ADDR A:0x656a107c
y.create.l HWIO_DEMBACK_WRTR2_XFER_CTL_DB1_ADDR A:0x656a1080
y.create.l HWIO_DEMBACK_WRTR3_CFG0_DB1_ADDR A:0x656a1084
y.create.l HWIO_DEMBACK_WRTR3_CFG1_DB1_ADDR A:0x656a1088
y.create.l HWIO_DEMBACK_WRTR3_XFER_CTL_DB1_ADDR A:0x656a108c
y.create.l HWIO_DEMBACK_BRDG_CTL_DB1_ADDR A:0x656a1090
y.create.l HWIO_DEMBACK_BRDG_STATUS_DB1_ADDR A:0x656a1094
y.create.l HWIO_DEMBACK_BRDG_CLEAR_DB1_ADDR A:0x656a1098
y.create.l HWIO_DEMBACK_DBG_CFG0_DB1_ADDR A:0x656a109c
y.create.l HWIO_DEMBACK_DBG_CFG1_DB1_ADDR A:0x656a10a0
y.create.l HWIO_DEMBACK_DBG_CTL_DB1_ADDR A:0x656a10a4
y.create.l HWIO_DEMBACK_DBG_MATCH_MASK0_DB1_ADDR A:0x656a10a8
y.create.l HWIO_DEMBACK_DBG_MATCH_MASK1_DB1_ADDR A:0x656a10ac
y.create.l HWIO_DEMBACK_DBG_MATCH_PATTERN0_DB1_ADDR A:0x656a10b0
y.create.l HWIO_DEMBACK_DBG_MATCH_PATTERN1_DB1_ADDR A:0x656a10b4
y.create.l HWIO_DEMBACK_DBG_TRACE_LEN_DB1_ADDR A:0x656a10b8
y.create.l HWIO_DEMBACK_DBG_WINDOW_LEN_DB1_ADDR A:0x656a10bc
y.create.l HWIO_DEMBACK_DBG_TRIGGER_LEN_DB1_ADDR A:0x656a10c0
y.create.l HWIO_LTE_DBE_PHICH_STATUS_DB1_ADDR A:0x656a2000
y.create.l HWIO_LTE_DBE_PCFICH_STATUS_DB1_ADDR A:0x656a2004
y.create.l HWIO_LTE_DBE_SCRAMBLE_SEED_FF_X1_SEED_DB1_ADDR A:0x656a2008
y.create.l HWIO_LTE_DBE_TESTBUS_ENABLE_DB1_ADDR A:0x656a200c
y.create.l HWIO_LTE_DBE_TESTBUS_STATUS_DB1_ADDR A:0x656a2010
y.create.l HWIO_LTE_DBE_PBCH_CMD_COUNT_DB1_ADDR A:0x656a2014
y.create.l HWIO_LTE_DBE_PDCCH_CMD_COUNT_DB1_ADDR A:0x656a2018
y.create.l HWIO_LTE_DBE_PDSCH_CMD_COUNT_DB1_ADDR A:0x656a201c
y.create.l HWIO_LTE_DBE_PBCH_DONE_COUNT_DB1_ADDR A:0x656a2020
y.create.l HWIO_LTE_DBE_PDCCH_DONE_COUNT_DB1_ADDR A:0x656a2024
y.create.l HWIO_LTE_DBE_PDSCH_DONE_COUNT_DB1_ADDR A:0x656a2028
y.create.l HWIO_TESTBUS_ENABLE_DB1_ADDR A:0x656a3000
y.create.l HWIO_TESTBUS_STATUS_DB1_ADDR A:0x656a3004
y.create.l HWIO_DBACK_AMP_EST0_0_DB1_ADDR A:0x656a4000
y.create.l HWIO_DBACK_AMP_EST0_1_DB1_ADDR A:0x656a4008
y.create.l HWIO_DBACK_AMP_EST0_2_DB1_ADDR A:0x656a4010
y.create.l HWIO_DBACK_AMP_EST0_3_DB1_ADDR A:0x656a4018
y.create.l HWIO_DBACK_AMP_EST0_4_DB1_ADDR A:0x656a4020
y.create.l HWIO_DBACK_AMP_EST0_5_DB1_ADDR A:0x656a4028
y.create.l HWIO_DBACK_ENG_EST0_0_DB1_ADDR A:0x656a4004
y.create.l HWIO_DBACK_ENG_EST0_1_DB1_ADDR A:0x656a400c
y.create.l HWIO_DBACK_ENG_EST0_2_DB1_ADDR A:0x656a4014
y.create.l HWIO_DBACK_ENG_EST0_3_DB1_ADDR A:0x656a401c
y.create.l HWIO_DBACK_ENG_EST0_4_DB1_ADDR A:0x656a4024
y.create.l HWIO_DBACK_ENG_EST0_5_DB1_ADDR A:0x656a402c
y.create.l HWIO_DBACK_AMP_EST1_0_DB1_ADDR A:0x656a4030
y.create.l HWIO_DBACK_AMP_EST1_1_DB1_ADDR A:0x656a4038
y.create.l HWIO_DBACK_AMP_EST1_2_DB1_ADDR A:0x656a4040
y.create.l HWIO_DBACK_AMP_EST1_3_DB1_ADDR A:0x656a4048
y.create.l HWIO_DBACK_AMP_EST1_4_DB1_ADDR A:0x656a4050
y.create.l HWIO_DBACK_AMP_EST1_5_DB1_ADDR A:0x656a4058
y.create.l HWIO_DBACK_ENG_EST1_0_DB1_ADDR A:0x656a4034
y.create.l HWIO_DBACK_ENG_EST1_1_DB1_ADDR A:0x656a403c
y.create.l HWIO_DBACK_ENG_EST1_2_DB1_ADDR A:0x656a4044
y.create.l HWIO_DBACK_ENG_EST1_3_DB1_ADDR A:0x656a404c
y.create.l HWIO_DBACK_ENG_EST1_4_DB1_ADDR A:0x656a4054
y.create.l HWIO_DBACK_ENG_EST1_5_DB1_ADDR A:0x656a405c
y.create.l HWIO_DBACK_HS_CH0_PART1_DEC_DATA0_DB1_ADDR A:0x656a4060
y.create.l HWIO_DBACK_HS_CH1_PART1_DEC_DATA0_DB1_ADDR A:0x656a406c
y.create.l HWIO_DBACK_HS_CH2_PART1_DEC_DATA0_DB1_ADDR A:0x656a4078
y.create.l HWIO_DBACK_HS_CH3_PART1_DEC_DATA0_DB1_ADDR A:0x656a4084
y.create.l HWIO_DBACK_HS_CH4_PART1_DEC_DATA0_DB1_ADDR A:0x656a4090
y.create.l HWIO_DBACK_HS_CH5_PART1_DEC_DATA0_DB1_ADDR A:0x656a409c
y.create.l HWIO_DBACK_HS_CH6_PART1_DEC_DATA0_DB1_ADDR A:0x656a40a8
y.create.l HWIO_DBACK_HS_CH7_PART1_DEC_DATA0_DB1_ADDR A:0x656a40b4
y.create.l HWIO_DBACK_HS_CH8_PART1_DEC_DATA0_DB1_ADDR A:0x656a40c0
y.create.l HWIO_DBACK_HS_CH9_PART1_DEC_DATA0_DB1_ADDR A:0x656a40cc
y.create.l HWIO_DBACK_HS_CH0_PART1_DEC_STAT_DB1_ADDR A:0x656a4064
y.create.l HWIO_DBACK_HS_CH1_PART1_DEC_STAT_DB1_ADDR A:0x656a4070
y.create.l HWIO_DBACK_HS_CH2_PART1_DEC_STAT_DB1_ADDR A:0x656a407c
y.create.l HWIO_DBACK_HS_CH3_PART1_DEC_STAT_DB1_ADDR A:0x656a4088
y.create.l HWIO_DBACK_HS_CH4_PART1_DEC_STAT_DB1_ADDR A:0x656a4094
y.create.l HWIO_DBACK_HS_CH5_PART1_DEC_STAT_DB1_ADDR A:0x656a40a0
y.create.l HWIO_DBACK_HS_CH6_PART1_DEC_STAT_DB1_ADDR A:0x656a40ac
y.create.l HWIO_DBACK_HS_CH7_PART1_DEC_STAT_DB1_ADDR A:0x656a40b8
y.create.l HWIO_DBACK_HS_CH8_PART1_DEC_STAT_DB1_ADDR A:0x656a40c4
y.create.l HWIO_DBACK_HS_CH9_PART1_DEC_STAT_DB1_ADDR A:0x656a40d0
y.create.l HWIO_DBACK_HS_CH0_SLOT1_AE_EST_DB1_ADDR A:0x656a4068
y.create.l HWIO_DBACK_HS_CH1_SLOT1_AE_EST_DB1_ADDR A:0x656a4074
y.create.l HWIO_DBACK_HS_CH2_SLOT1_AE_EST_DB1_ADDR A:0x656a4080
y.create.l HWIO_DBACK_HS_CH3_SLOT1_AE_EST_DB1_ADDR A:0x656a408c
y.create.l HWIO_DBACK_HS_CH4_SLOT1_AE_EST_DB1_ADDR A:0x656a4098
y.create.l HWIO_DBACK_HS_CH5_SLOT1_AE_EST_DB1_ADDR A:0x656a40a4
y.create.l HWIO_DBACK_HS_CH6_SLOT1_AE_EST_DB1_ADDR A:0x656a40b0
y.create.l HWIO_DBACK_HS_CH7_SLOT1_AE_EST_DB1_ADDR A:0x656a40bc
y.create.l HWIO_DBACK_HS_CH8_SLOT1_AE_EST_DB1_ADDR A:0x656a40c8
y.create.l HWIO_DBACK_HS_CH9_SLOT1_AE_EST_DB1_ADDR A:0x656a40d4
y.create.l HWIO_DBACK_HS_CH0_PART2_DEC_DATA1_DB1_ADDR A:0x656a40d8
y.create.l HWIO_DBACK_HS_CH1_PART2_DEC_DATA1_DB1_ADDR A:0x656a40e8
y.create.l HWIO_DBACK_HS_CH2_PART2_DEC_DATA1_DB1_ADDR A:0x656a40f8
y.create.l HWIO_DBACK_HS_CH3_PART2_DEC_DATA1_DB1_ADDR A:0x656a4108
y.create.l HWIO_DBACK_HS_CH4_PART2_DEC_DATA1_DB1_ADDR A:0x656a4118
y.create.l HWIO_DBACK_HS_CH5_PART2_DEC_DATA1_DB1_ADDR A:0x656a4128
y.create.l HWIO_DBACK_HS_CH6_PART2_DEC_DATA1_DB1_ADDR A:0x656a4138
y.create.l HWIO_DBACK_HS_CH7_PART2_DEC_DATA1_DB1_ADDR A:0x656a4148
y.create.l HWIO_DBACK_HS_CH8_PART2_DEC_DATA1_DB1_ADDR A:0x656a4158
y.create.l HWIO_DBACK_HS_CH9_PART2_DEC_DATA1_DB1_ADDR A:0x656a4168
y.create.l HWIO_DBACK_HS_CH0_PART2_DEC_STAT_DB1_ADDR A:0x656a40dc
y.create.l HWIO_DBACK_HS_CH1_PART2_DEC_STAT_DB1_ADDR A:0x656a40ec
y.create.l HWIO_DBACK_HS_CH2_PART2_DEC_STAT_DB1_ADDR A:0x656a40fc
y.create.l HWIO_DBACK_HS_CH3_PART2_DEC_STAT_DB1_ADDR A:0x656a410c
y.create.l HWIO_DBACK_HS_CH4_PART2_DEC_STAT_DB1_ADDR A:0x656a411c
y.create.l HWIO_DBACK_HS_CH5_PART2_DEC_STAT_DB1_ADDR A:0x656a412c
y.create.l HWIO_DBACK_HS_CH6_PART2_DEC_STAT_DB1_ADDR A:0x656a413c
y.create.l HWIO_DBACK_HS_CH7_PART2_DEC_STAT_DB1_ADDR A:0x656a414c
y.create.l HWIO_DBACK_HS_CH8_PART2_DEC_STAT_DB1_ADDR A:0x656a415c
y.create.l HWIO_DBACK_HS_CH9_PART2_DEC_STAT_DB1_ADDR A:0x656a416c
y.create.l HWIO_DBACK_HS_CH0_SLOT2_AE_EST_DB1_ADDR A:0x656a40e0
y.create.l HWIO_DBACK_HS_CH1_SLOT2_AE_EST_DB1_ADDR A:0x656a40f0
y.create.l HWIO_DBACK_HS_CH2_SLOT2_AE_EST_DB1_ADDR A:0x656a4100
y.create.l HWIO_DBACK_HS_CH3_SLOT2_AE_EST_DB1_ADDR A:0x656a4110
y.create.l HWIO_DBACK_HS_CH4_SLOT2_AE_EST_DB1_ADDR A:0x656a4120
y.create.l HWIO_DBACK_HS_CH5_SLOT2_AE_EST_DB1_ADDR A:0x656a4130
y.create.l HWIO_DBACK_HS_CH6_SLOT2_AE_EST_DB1_ADDR A:0x656a4140
y.create.l HWIO_DBACK_HS_CH7_SLOT2_AE_EST_DB1_ADDR A:0x656a4150
y.create.l HWIO_DBACK_HS_CH8_SLOT2_AE_EST_DB1_ADDR A:0x656a4160
y.create.l HWIO_DBACK_HS_CH9_SLOT2_AE_EST_DB1_ADDR A:0x656a4170
y.create.l HWIO_DBACK_HS_CH0_SLOT3_AE_EST_DB1_ADDR A:0x656a40e4
y.create.l HWIO_DBACK_HS_CH1_SLOT3_AE_EST_DB1_ADDR A:0x656a40f4
y.create.l HWIO_DBACK_HS_CH2_SLOT3_AE_EST_DB1_ADDR A:0x656a4104
y.create.l HWIO_DBACK_HS_CH3_SLOT3_AE_EST_DB1_ADDR A:0x656a4114
y.create.l HWIO_DBACK_HS_CH4_SLOT3_AE_EST_DB1_ADDR A:0x656a4124
y.create.l HWIO_DBACK_HS_CH5_SLOT3_AE_EST_DB1_ADDR A:0x656a4134
y.create.l HWIO_DBACK_HS_CH6_SLOT3_AE_EST_DB1_ADDR A:0x656a4144
y.create.l HWIO_DBACK_HS_CH7_SLOT3_AE_EST_DB1_ADDR A:0x656a4154
y.create.l HWIO_DBACK_HS_CH8_SLOT3_AE_EST_DB1_ADDR A:0x656a4164
y.create.l HWIO_DBACK_HS_CH9_SLOT3_AE_EST_DB1_ADDR A:0x656a4174
y.create.l HWIO_DBACK_EAGCH_DEC_DATA_DB1_ADDR A:0x656a4178
y.create.l HWIO_DBACK_EAGCH_DEC_STAT_DB1_ADDR A:0x656a417c
y.create.l HWIO_DBACK_EAGCH_METRIC_DB1_ADDR A:0x656a4180
y.create.l HWIO_DBACK_HSSCCH_CTL1_DB1_ADDR A:0x656a4184
y.create.l HWIO_DBACK_HSSCCH_CTL2_DB1_ADDR A:0x656a4188
y.create.l HWIO_HS_SCCH_PART2_DECODE_MAP_DB1_ADDR A:0x656a418c
y.create.l HWIO_DBACK_CH0_UEID_MASK_0_DB1_ADDR A:0x656a4190
y.create.l HWIO_DBACK_CH1_UEID_MASK_0_DB1_ADDR A:0x656a4194
y.create.l HWIO_DBACK_CH2_UEID_MASK_0_DB1_ADDR A:0x656a4198
y.create.l HWIO_DBACK_CH3_UEID_MASK_0_DB1_ADDR A:0x656a419c
y.create.l HWIO_DBACK_CH4_UEID_MASK_0_DB1_ADDR A:0x656a41a0
y.create.l HWIO_DBACK_CH5_UEID_MASK_0_DB1_ADDR A:0x656a41a4
y.create.l HWIO_DBACK_CH6_UEID_MASK_0_DB1_ADDR A:0x656a41a8
y.create.l HWIO_DBACK_CH7_UEID_MASK_0_DB1_ADDR A:0x656a41ac
y.create.l HWIO_DBACK_CH8_UEID_MASK_0_DB1_ADDR A:0x656a41b0
y.create.l HWIO_DBACK_CH9_UEID_MASK_0_DB1_ADDR A:0x656a41b4
y.create.l HWIO_DBACK_CH0_UEID_MASK_1_DB1_ADDR A:0x656a41b8
y.create.l HWIO_DBACK_CH1_UEID_MASK_1_DB1_ADDR A:0x656a41bc
y.create.l HWIO_DBACK_CH2_UEID_MASK_1_DB1_ADDR A:0x656a41c0
y.create.l HWIO_DBACK_CH3_UEID_MASK_1_DB1_ADDR A:0x656a41c4
y.create.l HWIO_DBACK_CH4_UEID_MASK_1_DB1_ADDR A:0x656a41c8
y.create.l HWIO_DBACK_CH5_UEID_MASK_1_DB1_ADDR A:0x656a41cc
y.create.l HWIO_DBACK_CH6_UEID_MASK_1_DB1_ADDR A:0x656a41d0
y.create.l HWIO_DBACK_CH7_UEID_MASK_1_DB1_ADDR A:0x656a41d4
y.create.l HWIO_DBACK_CH8_UEID_MASK_1_DB1_ADDR A:0x656a41d8
y.create.l HWIO_DBACK_CH9_UEID_MASK_1_DB1_ADDR A:0x656a41dc
y.create.l HWIO_DBACK_HSSCCH_PART1_TRIGGER_DB1_ADDR A:0x656a41e0
y.create.l HWIO_DBACK_HSSCCH_YAM_THRES_DB1_ADDR A:0x656a41e4
y.create.l HWIO_DBACK_HSSCCH_PART2_TRIGGER_DB1_ADDR A:0x656a41e8
y.create.l HWIO_DBACK_HSSCCH_STATUS_DB1_ADDR A:0x656a41ec
y.create.l HWIO_DBACK_EAGCH_CONFIG_DB1_ADDR A:0x656a41f0
y.create.l HWIO_DBACK_EAGCH_CTL_DB1_ADDR A:0x656a41f4
y.create.l HWIO_DBACK_EAGCH_TRIGGER_DB1_ADDR A:0x656a41f8
y.create.l HWIO_DBACK_EAGCH_RM_PATTERN_0_DB1_ADDR A:0x656a41fc
y.create.l HWIO_DBACK_EAGCH_RM_PATTERN_1_DB1_ADDR A:0x656a4200
y.create.l HWIO_DBACK_EAGCH_RM_PATTERN_2_DB1_ADDR A:0x656a4204
y.create.l HWIO_DBACK_HS_EUL_CTL_CH_RST_DB1_ADDR A:0x656a4208
y.create.l HWIO_DBACK_NONHS_WCB_SIZE_DB1_ADDR A:0x656a420c
y.create.l HWIO_DBACK_HS_WCB_SIZE_DB1_ADDR A:0x656a4210
y.create.l HWIO_DBACK_PART1_INT_STATUS_DB1_ADDR A:0x656a4214
y.create.l HWIO_DBACK_PART1_INT_CLR_DB1_ADDR A:0x656a4218
y.create.l HWIO_DBACK_PART1_INT_EN_DB1_ADDR A:0x656a421c
y.create.l HWIO_DBACK_PART2_INT_STATUS_DB1_ADDR A:0x656a4220
y.create.l HWIO_DBACK_PART2_INT_CLR_DB1_ADDR A:0x656a4224
y.create.l HWIO_DBACK_PART2_INT_EN_DB1_ADDR A:0x656a4228
y.create.l HWIO_DBACK_EAGCH_INT_EN_DB1_ADDR A:0x656a422c
y.create.l HWIO_DBACK_TEST_MEM_SEL_DB1_ADDR A:0x656a4230
y.create.l HWIO_DBACK_TEST_BUS_SEL_DB1_ADDR A:0x656a4234
y.create.l HWIO_DBACK_MEM_ADDR_DB1_ADDR A:0x656a4238
y.create.l HWIO_DBACK_MEM_DATA0_DB1_ADDR A:0x656a423c
y.create.l HWIO_DBACK_MEM_DATA1_DB1_ADDR A:0x656a4240
y.create.l HWIO_DBACK_MEM_DATA2_DB1_ADDR A:0x656a4244
y.create.l HWIO_DBACK_MEM_DATA3_DB1_ADDR A:0x656a4248
y.create.l HWIO_DBACK_MEM_DATA4_DB1_ADDR A:0x656a424c
y.create.l HWIO_T_DBACK_HS_CH0_DEC_DATA0_DB1_ADDR A:0x656a5000
y.create.l HWIO_T_DBACK_HS_CH1_DEC_DATA0_DB1_ADDR A:0x656a500c
y.create.l HWIO_T_DBACK_HS_CH2_DEC_DATA0_DB1_ADDR A:0x656a5018
y.create.l HWIO_T_DBACK_HS_CH3_DEC_DATA0_DB1_ADDR A:0x656a5024
y.create.l HWIO_T_DBACK_HS_CH0_DEC_DATA1_DB1_ADDR A:0x656a5004
y.create.l HWIO_T_DBACK_HS_CH1_DEC_DATA1_DB1_ADDR A:0x656a5010
y.create.l HWIO_T_DBACK_HS_CH2_DEC_DATA1_DB1_ADDR A:0x656a501c
y.create.l HWIO_T_DBACK_HS_CH3_DEC_DATA1_DB1_ADDR A:0x656a5028
y.create.l HWIO_T_DBACK_HS_CH0_DEC_STAT_DB1_ADDR A:0x656a5008
y.create.l HWIO_T_DBACK_HS_CH1_DEC_STAT_DB1_ADDR A:0x656a5014
y.create.l HWIO_T_DBACK_HS_CH2_DEC_STAT_DB1_ADDR A:0x656a5020
y.create.l HWIO_T_DBACK_HS_CH3_DEC_STAT_DB1_ADDR A:0x656a502c
y.create.l HWIO_T_DBACK_EAGCH0_DEC_DATA0_DB1_ADDR A:0x656a5030
y.create.l HWIO_T_DBACK_EAGCH1_DEC_DATA0_DB1_ADDR A:0x656a5040
y.create.l HWIO_T_DBACK_EAGCH2_DEC_DATA0_DB1_ADDR A:0x656a5050
y.create.l HWIO_T_DBACK_EAGCH3_DEC_DATA0_DB1_ADDR A:0x656a5060
y.create.l HWIO_T_DBACK_EAGCH0_DEC_DATA1_DB1_ADDR A:0x656a5034
y.create.l HWIO_T_DBACK_EAGCH1_DEC_DATA1_DB1_ADDR A:0x656a5044
y.create.l HWIO_T_DBACK_EAGCH2_DEC_DATA1_DB1_ADDR A:0x656a5054
y.create.l HWIO_T_DBACK_EAGCH3_DEC_DATA1_DB1_ADDR A:0x656a5064
y.create.l HWIO_T_DBACK_EAGCH0_DEC_STAT_DB1_ADDR A:0x656a5038
y.create.l HWIO_T_DBACK_EAGCH1_DEC_STAT_DB1_ADDR A:0x656a5048
y.create.l HWIO_T_DBACK_EAGCH2_DEC_STAT_DB1_ADDR A:0x656a5058
y.create.l HWIO_T_DBACK_EAGCH3_DEC_STAT_DB1_ADDR A:0x656a5068
y.create.l HWIO_T_DBACK_EAGCH0_METRIC_DB1_ADDR A:0x656a503c
y.create.l HWIO_T_DBACK_EAGCH1_METRIC_DB1_ADDR A:0x656a504c
y.create.l HWIO_T_DBACK_EAGCH2_METRIC_DB1_ADDR A:0x656a505c
y.create.l HWIO_T_DBACK_EAGCH3_METRIC_DB1_ADDR A:0x656a506c
y.create.l HWIO_T_DBACK_FPACH_DEC_DATA0_DB1_ADDR A:0x656a5070
y.create.l HWIO_T_DBACK_FPACH_DEC_DATA1_DB1_ADDR A:0x656a5074
y.create.l HWIO_T_DBACK_FPACH_DEC_STAT_DB1_ADDR A:0x656a5078
y.create.l HWIO_T_DBACK_TEST_MEM_SEL_DB1_ADDR A:0x656a507c
y.create.l HWIO_T_DBACK_TEST_BUS_SEL_DB1_ADDR A:0x656a5080
y.create.l HWIO_T_DBACK_MEM_ADDR_DB1_ADDR A:0x656a5084
y.create.l HWIO_T_DBACK_MEM_DATA0_DB1_ADDR A:0x656a5088
y.create.l HWIO_T_DBACK_MEM_DATA1_DB1_ADDR A:0x656a508c
y.create.l HWIO_T_DBACK_MEM_DATA2_DB1_ADDR A:0x656a5090
y.create.l HWIO_T_DBACK_MEM_DATA3_DB1_ADDR A:0x656a5094
y.create.l HWIO_T_DBACK_MEM_DATA4_DB1_ADDR A:0x656a5098
y.create.l HWIO_T_DBACK_HS_CH0_DC_DEC_DATA0_DB1_ADDR A:0x656a509c
y.create.l HWIO_T_DBACK_HS_CH1_DC_DEC_DATA0_DB1_ADDR A:0x656a50a8
y.create.l HWIO_T_DBACK_HS_CH2_DC_DEC_DATA0_DB1_ADDR A:0x656a50b4
y.create.l HWIO_T_DBACK_HS_CH3_DC_DEC_DATA0_DB1_ADDR A:0x656a50c0
y.create.l HWIO_T_DBACK_HS_CH0_DC_DEC_DATA1_DB1_ADDR A:0x656a50a0
y.create.l HWIO_T_DBACK_HS_CH1_DC_DEC_DATA1_DB1_ADDR A:0x656a50ac
y.create.l HWIO_T_DBACK_HS_CH2_DC_DEC_DATA1_DB1_ADDR A:0x656a50b8
y.create.l HWIO_T_DBACK_HS_CH3_DC_DEC_DATA1_DB1_ADDR A:0x656a50c4
y.create.l HWIO_T_DBACK_HS_CH0_DC_DEC_STAT_DB1_ADDR A:0x656a50a4
y.create.l HWIO_T_DBACK_HS_CH1_DC_DEC_STAT_DB1_ADDR A:0x656a50b0
y.create.l HWIO_T_DBACK_HS_CH2_DC_DEC_STAT_DB1_ADDR A:0x656a50bc
y.create.l HWIO_T_DBACK_HS_CH3_DC_DEC_STAT_DB1_ADDR A:0x656a50c8
y.create.l HWIO_DINT_CFG_DB1_ADDR A:0x656a6000
y.create.l HWIO_DINT_CH0_CFG_DB1_ADDR A:0x656a6004
y.create.l HWIO_DINT_CH1_CFG_DB1_ADDR A:0x656a6008
y.create.l HWIO_DINT_CH2_CFG_DB1_ADDR A:0x656a600c
y.create.l HWIO_TD_BLOCK_SIZE_DB1_ADDR A:0x656a6014
y.create.l HWIO_TD_INTLV_CFG_LO_DB1_ADDR A:0x656a6018
y.create.l HWIO_TD_INTLV_CFG_HI_DB1_ADDR A:0x656a601c
y.create.l HWIO_TD_INTLV_SIZE_LO_DB1_ADDR A:0x656a6020
y.create.l HWIO_TD_PUNCT_LO_DB1_ADDR A:0x656a6024
y.create.l HWIO_TD_PUNCT_HI_DB1_ADDR A:0x656a6028
y.create.l HWIO_DINT_PKT_OFFSET_DB1_ADDR A:0x656a6030
y.create.l HWIO_DINT_PKT_CFG_DB1_ADDR A:0x656a6034
y.create.l HWIO_DINT_TASK_OFFSET_DB1_ADDR A:0x656a6038
y.create.l HWIO_DINT_TASK_LIST_DB1_ADDR A:0x656a603c
y.create.l HWIO_TST_SYNC_DINT_DB1_ADDR A:0x656a6040
y.create.l HWIO_TST_CH0_SYMS_DB1_ADDR A:0x656a6044
y.create.l HWIO_TST_CH1_SYMS_DB1_ADDR A:0x656a6048
y.create.l HWIO_TST_CH2_SYMS_DB1_ADDR A:0x656a604c
y.create.l HWIO_TST_SEL_DINT_DB1_ADDR A:0x656a6054
y.create.l HWIO_DINT_OTD_CFG_DB1_ADDR A:0x656a6058
y.create.l HWIO_TST_SYS_TIME_DB1_ADDR A:0x656a6070
y.create.l HWIO_DEINT_DBG_BUS_CTL_DB1_ADDR A:0x656a6074
y.create.l HWIO_DEC_CLR_INT_STATUS_DB1_ADDR A:0x656a6084
y.create.l HWIO_DEINT_CLK_STATUS_DB1_ADDR A:0x656a6088
y.create.l HWIO_DEC_DONE_INT_STATUS_DB1_ADDR A:0x656a608c
y.create.l HWIO_DEINT_TASK_STATUS_DB1_ADDR A:0x656a6090
y.create.l HWIO_DEINT_FRMHYP_STATUS_DB1_ADDR A:0x656a6094
y.create.l HWIO_DINT_VD_RD_ADDR_DB1_ADDR A:0x656a6098
y.create.l HWIO_DINT_FCH_CFG0_DB1_ADDR A:0x656a609c
y.create.l HWIO_DINT_FCH_CFG1_DB1_ADDR A:0x656a60a0
y.create.l HWIO_DINT_FCH_TRIGGER_DB1_ADDR A:0x656a60a4
y.create.l HWIO_DINT_FCH_WR_BANK_DB1_ADDR A:0x656a60a8
y.create.l HWIO_DINT_FCH_EGTH_HYP_CFG0_DB1_ADDR A:0x656a60ac
y.create.l HWIO_DINT_FCH_EGTH_HYP_CFG1_DB1_ADDR A:0x656a60b0
y.create.l HWIO_DINT_FCH_EGTH_HYP_CFG2_DB1_ADDR A:0x656a60b4
y.create.l HWIO_DINT_FCH_EGTH_HYP_CFG3_DB1_ADDR A:0x656a60b8
y.create.l HWIO_DINT_FCH_QRTR_HYP_CFG0_DB1_ADDR A:0x656a60bc
y.create.l HWIO_DINT_FCH_QRTR_HYP_CFG1_DB1_ADDR A:0x656a60c0
y.create.l HWIO_DINT_FCH_QRTR_HYP_CFG2_DB1_ADDR A:0x656a60c4
y.create.l HWIO_DINT_FCH_QRTR_HYP_CFG3_DB1_ADDR A:0x656a60c8
y.create.l HWIO_DINT_FCH_HALF_HYP_CFG0_DB1_ADDR A:0x656a60cc
y.create.l HWIO_DINT_FCH_HALF_HYP_CFG1_DB1_ADDR A:0x656a60d0
y.create.l HWIO_DINT_FCH_HALF_HYP_CFG2_DB1_ADDR A:0x656a60d4
y.create.l HWIO_DINT_FCH_HALF_HYP_CFG3_DB1_ADDR A:0x656a60d8
y.create.l HWIO_DINT_FCH_FULL_HYP_CFG0_DB1_ADDR A:0x656a60dc
y.create.l HWIO_DINT_FCH_FULL_HYP_CFG1_DB1_ADDR A:0x656a60e0
y.create.l HWIO_DINT_FCH_FULL_HYP_CFG2_DB1_ADDR A:0x656a60e4
y.create.l HWIO_DINT_FCH_FULL_HYP_CFG3_DB1_ADDR A:0x656a60e8
y.create.l HWIO_COMB_FUND_SOFT_DEC_IQ_WR_DB1_ADDR A:0x656a6100
y.create.l HWIO_C_SYNC_TRIG_REG_DB1_ADDR A:0x656a6104
y.create.l HWIO_CH0_Q_SOFTDEC_ENABLE_DB1_ADDR A:0x656a6108
y.create.l HWIO_CH1_CONTROL_DB1_ADDR A:0x656a610c
y.create.l HWIO_CH2_CONTROL_DB1_ADDR A:0x656a6110
y.create.l HWIO_CDMA_WIDGET_STATUS0_DB1_ADDR A:0x656a6114
y.create.l HWIO_RESET_STATUS0_DB1_ADDR A:0x656a6118
y.create.l HWIO_CDMA_WIDGET_STATUS1_DB1_ADDR A:0x656a611c
y.create.l HWIO_RESET_STATUS1_DB1_ADDR A:0x656a6120
y.create.l HWIO_CDMA_WIDGET_TEST_CTL_DB1_ADDR A:0x656a6124
y.create.l HWIO_HDR_DINT_STATUS_DB1_ADDR A:0x656a7024
y.create.l HWIO_HDR_DINT_DGB_BUS_DB1_ADDR A:0x656a7080
y.create.l HWIO_HDR_DINT_CLK_STATUS_DB1_ADDR A:0x656a7084
y.create.l HWIO_SVD_TBVD_CLK_STATUS_REG_DB1_ADDR A:0x656a8000
y.create.l HWIO_SVD_TBVD_HW_IDLE_DB1_ADDR A:0x656a8004
y.create.l HWIO_SVD_TBVD_TESTBUS_ENABLE_DB1_ADDR A:0x656a8008
y.create.l HWIO_SVD_MODE_DB1_ADDR A:0x656a800c
y.create.l HWIO_SVD_POLY2IJ_DB1_ADDR A:0x656a8010
y.create.l HWIO_SVD_POLY3IJ_DB1_ADDR A:0x656a8014
y.create.l HWIO_SVD_POLY3K_DB1_ADDR A:0x656a8018
y.create.l HWIO_SVD_POLY4IJ_DB1_ADDR A:0x656a801c
y.create.l HWIO_SVD_POLY4KL_DB1_ADDR A:0x656a8020
y.create.l HWIO_SVD_TESTCON_DB1_ADDR A:0x656a8024
y.create.l HWIO_SVD_TESTOUT_DB1_ADDR A:0x656a8028
y.create.l HWIO_SVD_TEST_MEM_SEL_DB1_ADDR A:0x656a802c
y.create.l HWIO_SVD_TEST_MEM_ADDR_DB1_ADDR A:0x656a8030
y.create.l HWIO_SVD_TEST_MEM_WRITE_DB1_ADDR A:0x656a8034
y.create.l HWIO_SVD_TEST_MEM_READ0_DB1_ADDR A:0x656a8038
y.create.l HWIO_SVD_TEST_MEM_READ1_DB1_ADDR A:0x656a803c
y.create.l HWIO_SVD_TEST_MEM_DIN_DB1_ADDR A:0x656a8040
y.create.l HWIO_TBVD_DEBUG_MEM_CMD_DB1_ADDR A:0x656a8044
y.create.l HWIO_TBVD_DEBUG_MEM_WR_DB1_ADDR A:0x656a8048
y.create.l HWIO_TBVD_DEBUG_MEM_RD_DB1_ADDR A:0x656a804c
y.create.l HWIO_LTE_DEMBACK_SCH_STATUS_WORD0_DB1_ADDR A:0x656a9000
y.create.l HWIO_LTE_DEMBACK_SCH_SHARED_WORD0_DB1_ADDR A:0x656a9100
y.create.l HWIO_LTE_DEMBACK_SCH_SHARED_WORD1_DB1_ADDR A:0x656a9104
y.create.l HWIO_LTE_DEMBACK_SCH_SHARED_WORD2_DB1_ADDR A:0x656a9108
y.create.l HWIO_LTE_DEMBACK_SCH_SHARED_WORD3_DB1_ADDR A:0x656a910c
y.create.l HWIO_LTE_DEMBACK_SCH_SHARED_WORD4_DB1_ADDR A:0x656a9110
y.create.l HWIO_LTE_DEMBACK_SCH_SHARED_WORD5_DB1_ADDR A:0x656a9114
y.create.l HWIO_PDSCH_HARQ_CFG_WORD0_DB1_ADDR A:0x656a9200
y.create.l HWIO_PDSCH_HARQ_CFG_WORD1_DB1_ADDR A:0x656a9204
y.create.l HWIO_PDSCH_HARQ_CFG_WORD2_DB1_ADDR A:0x656a9208
y.create.l HWIO_PDSCH_HARQ_CFG_WORD3_DB1_ADDR A:0x656a920c
y.create.l HWIO_PDSCH_HARQ_CFG_WORD4_DB1_ADDR A:0x656a9210
y.create.l HWIO_PDSCH_HARQ_CFG_WORD5_DB1_ADDR A:0x656a9214
y.create.l HWIO_PDSCH_HARQ_CFG_WORD6_DB1_ADDR A:0x656a9218
y.create.l HWIO_PDSCH_HARQ_CFG_WORD7_DB1_ADDR A:0x656a921c
y.create.l HWIO_PDSCH_HARQ_CFG_WORD8_DB1_ADDR A:0x656a9220
y.create.l HWIO_LTE_DEMBACK_CCH_STATUS_WORD0_DB1_ADDR A:0x656aa000
y.create.l HWIO_LTE_DEMBACK_CCH_SHARED_WORD0_DB1_ADDR A:0x656aa100
y.create.l HWIO_LTE_DEMBACK_CCH_SHARED_WORD1_DB1_ADDR A:0x656aa104
y.create.l HWIO_LTE_DEMBACK_CCH_SHARED_WORD2_DB1_ADDR A:0x656aa108
y.create.l HWIO_LTE_DEMBACK_CCH_SHARED_WORD3_DB1_ADDR A:0x656aa10c
y.create.l HWIO_LTE_DEMBACK_CCH_SHARED_WORD4_DB1_ADDR A:0x656aa110
y.create.l HWIO_LTE_DEMBACK_CCH_SHARED_WORD5_DB1_ADDR A:0x656aa114
y.create.l HWIO_LTE_DEMBACK_CCH_SHARED_WORD6_DB1_ADDR A:0x656aa118
y.create.l HWIO_LTE_DEMBACK_CCH_SHARED_WORD7_DB1_ADDR A:0x656aa11c
y.create.l HWIO_PDCCH_DEINT_CFG_WORD0_DB1_ADDR A:0x656aa200
y.create.l HWIO_PDCCH_DEINT_CFG_WORD1_DB1_ADDR A:0x656aa204
y.create.l HWIO_PDCCH_DEINT_CFG_WORD2_DB1_ADDR A:0x656aa208
y.create.l HWIO_SYMBOL0_REG_MAP_0_WORD0_DB1_ADDR A:0x656aa300
y.create.l HWIO_SYMBOL0_REG_MAP_0_WORD1_DB1_ADDR A:0x656aa304
y.create.l HWIO_SYMBOL0_REG_MAP_0_WORD2_DB1_ADDR A:0x656aa308
y.create.l HWIO_SYMBOL0_REG_MAP_0_WORD3_DB1_ADDR A:0x656aa30c
y.create.l HWIO_SYMBOL0_REG_MAP_0_WORD4_DB1_ADDR A:0x656aa310
y.create.l HWIO_SYMBOL0_REG_MAP_0_WORD5_DB1_ADDR A:0x656aa314
y.create.l HWIO_SYMBOL0_REG_MAP_0_WORD6_DB1_ADDR A:0x656aa318
y.create.l HWIO_SYMBOL0_REG_MAP_0_WORD7_DB1_ADDR A:0x656aa31c
y.create.l HWIO_SYMBOL0_REG_MAP_1_WORD0_DB1_ADDR A:0x656aa400
y.create.l HWIO_SYMBOL0_REG_MAP_1_WORD1_DB1_ADDR A:0x656aa404
y.create.l HWIO_SYMBOL0_REG_MAP_1_WORD2_DB1_ADDR A:0x656aa408
y.create.l HWIO_SYMBOL0_REG_MAP_1_WORD3_DB1_ADDR A:0x656aa40c
y.create.l HWIO_SYMBOL0_REG_MAP_1_WORD4_DB1_ADDR A:0x656aa410
y.create.l HWIO_SYMBOL0_REG_MAP_1_WORD5_DB1_ADDR A:0x656aa414
y.create.l HWIO_SYMBOL0_REG_MAP_1_WORD6_DB1_ADDR A:0x656aa418
y.create.l HWIO_SYMBOL0_REG_MAP_1_WORD7_DB1_ADDR A:0x656aa41c
y.create.l HWIO_SYMBOL0_REG_MAP_2_WORD0_DB1_ADDR A:0x656aa500
y.create.l HWIO_SYMBOL0_REG_MAP_2_WORD1_DB1_ADDR A:0x656aa504
y.create.l HWIO_SYMBOL0_REG_MAP_2_WORD2_DB1_ADDR A:0x656aa508
y.create.l HWIO_SYMBOL0_REG_MAP_2_WORD3_DB1_ADDR A:0x656aa50c
y.create.l HWIO_SYMBOL0_REG_MAP_2_WORD4_DB1_ADDR A:0x656aa510
y.create.l HWIO_SYMBOL0_REG_MAP_2_WORD5_DB1_ADDR A:0x656aa514
y.create.l HWIO_SYMBOL0_REG_MAP_2_WORD6_DB1_ADDR A:0x656aa518
y.create.l HWIO_SYMBOL0_REG_MAP_2_WORD7_DB1_ADDR A:0x656aa51c
y.create.l HWIO_SYMBOL1_REG_MAP_0_WORD0_DB1_ADDR A:0x656aa600
y.create.l HWIO_SYMBOL1_REG_MAP_0_WORD1_DB1_ADDR A:0x656aa604
y.create.l HWIO_SYMBOL1_REG_MAP_0_WORD2_DB1_ADDR A:0x656aa608
y.create.l HWIO_SYMBOL1_REG_MAP_0_WORD3_DB1_ADDR A:0x656aa60c
y.create.l HWIO_SYMBOL1_REG_MAP_0_WORD4_DB1_ADDR A:0x656aa610
y.create.l HWIO_SYMBOL1_REG_MAP_0_WORD5_DB1_ADDR A:0x656aa614
y.create.l HWIO_SYMBOL1_REG_MAP_0_WORD6_DB1_ADDR A:0x656aa618
y.create.l HWIO_SYMBOL1_REG_MAP_0_WORD7_DB1_ADDR A:0x656aa61c
y.create.l HWIO_SYMBOL1_REG_MAP_0_WORD8_DB1_ADDR A:0x656aa620
y.create.l HWIO_SYMBOL1_REG_MAP_0_WORD9_DB1_ADDR A:0x656aa624
y.create.l HWIO_SYMBOL1_REG_MAP_0_WORD10_DB1_ADDR A:0x656aa628
y.create.l HWIO_SYMBOL1_REG_MAP_1_WORD0_DB1_ADDR A:0x656aa700
y.create.l HWIO_SYMBOL1_REG_MAP_1_WORD1_DB1_ADDR A:0x656aa704
y.create.l HWIO_SYMBOL1_REG_MAP_1_WORD2_DB1_ADDR A:0x656aa708
y.create.l HWIO_SYMBOL1_REG_MAP_1_WORD3_DB1_ADDR A:0x656aa70c
y.create.l HWIO_SYMBOL1_REG_MAP_1_WORD4_DB1_ADDR A:0x656aa710
y.create.l HWIO_SYMBOL1_REG_MAP_1_WORD5_DB1_ADDR A:0x656aa714
y.create.l HWIO_SYMBOL1_REG_MAP_1_WORD6_DB1_ADDR A:0x656aa718
y.create.l HWIO_SYMBOL1_REG_MAP_1_WORD7_DB1_ADDR A:0x656aa71c
y.create.l HWIO_SYMBOL1_REG_MAP_1_WORD8_DB1_ADDR A:0x656aa720
y.create.l HWIO_SYMBOL1_REG_MAP_1_WORD9_DB1_ADDR A:0x656aa724
y.create.l HWIO_SYMBOL1_REG_MAP_1_WORD10_DB1_ADDR A:0x656aa728
y.create.l HWIO_SYMBOL2_REG_MAP_WORD0_DB1_ADDR A:0x656aa800
y.create.l HWIO_SYMBOL2_REG_MAP_WORD1_DB1_ADDR A:0x656aa804
y.create.l HWIO_SYMBOL2_REG_MAP_WORD2_DB1_ADDR A:0x656aa808
y.create.l HWIO_SYMBOL2_REG_MAP_WORD3_DB1_ADDR A:0x656aa80c
y.create.l HWIO_SYMBOL2_REG_MAP_WORD4_DB1_ADDR A:0x656aa810
y.create.l HWIO_SYMBOL2_REG_MAP_WORD5_DB1_ADDR A:0x656aa814
y.create.l HWIO_SYMBOL2_REG_MAP_WORD6_DB1_ADDR A:0x656aa818
y.create.l HWIO_SYMBOL2_REG_MAP_WORD7_DB1_ADDR A:0x656aa81c
y.create.l HWIO_SYMBOL2_REG_MAP_WORD8_DB1_ADDR A:0x656aa820
y.create.l HWIO_SYMBOL2_REG_MAP_WORD9_DB1_ADDR A:0x656aa824
y.create.l HWIO_SYMBOL2_REG_MAP_WORD10_DB1_ADDR A:0x656aa828
y.create.l HWIO_PBCH_DEINT_CFG_WORD0_DB1_ADDR A:0x656aa900
y.create.l HWIO_PBCH_DEINT_CFG_WORD1_DB1_ADDR A:0x656aa904
y.create.l HWIO_PBCH_DEINT_CFG_WORD2_DB1_ADDR A:0x656aa908
y.create.l HWIO_PBCH_DEINT_CFG_WORD3_DB1_ADDR A:0x656aa90c
y.create.l HWIO_PBCH_DEINT_CFG_WORD4_DB1_ADDR A:0x656aa910
y.create.l HWIO_PBCH_DEINT_CFG_WORD5_DB1_ADDR A:0x656aa914
y.create.l HWIO_PBCH_DEINT_CFG_WORD6_DB1_ADDR A:0x656aa918
y.create.l HWIO_PBCH_DEINT_CFG_WORD7_DB1_ADDR A:0x656aa91c
y.create.l HWIO_PBCH_DEINT_CFG_WORD8_DB1_ADDR A:0x656aa920
y.create.l HWIO_PBCH_DEINT_CFG_WORD9_DB1_ADDR A:0x656aa924
y.create.l HWIO_PBCH_DEINT_CFG_WORD10_DB1_ADDR A:0x656aa928
y.create.l HWIO_PDCCH_REG_REORDER_WORD0_DB1_ADDR A:0x656aaa00
y.create.l HWIO_PDCCH_REG_REORDER_WORD1_DB1_ADDR A:0x656aaa04
y.create.l HWIO_PDCCH_REG_REORDER_WORD2_DB1_ADDR A:0x656aaa08
y.create.l HWIO_PDCCH_REG_REORDER_WORD3_DB1_ADDR A:0x656aaa0c
y.create.l HWIO_PDCCH_REG_REORDER_WORD4_DB1_ADDR A:0x656aaa10
y.create.l HWIO_PBCH_FOH_WORD0_DB1_ADDR A:0x656aab00
y.create.l HWIO_PBCH_FOH_WORD1_DB1_ADDR A:0x656aab04
y.create.l HWIO_PBCH_FOH_WORD2_DB1_ADDR A:0x656aab08
y.create.l HWIO_PDSCH_REENC_TB_CFG_WORD0_DB1_ADDR A:0x656ab100
y.create.l HWIO_PDSCH_REENC_TB_CFG_WORD1_DB1_ADDR A:0x656ab104
y.create.l HWIO_PDSCH_REENC_TB_CFG_WORD2_DB1_ADDR A:0x656ab108
y.create.l HWIO_PDSCH_REENC_CB_WORD0_DB1_ADDR A:0x656ab200
y.create.l HWIO_PDSCH_REENC_CB_WORD1_DB1_ADDR A:0x656ab204
y.create.l HWIO_PDSCH_REENC_CB_WORD2_DB1_ADDR A:0x656ab208
y.create.l HWIO_PBCH_REENC_WORD0_DB1_ADDR A:0x656ab300
y.create.l HWIO_PBCH_REENC_WORD1_DB1_ADDR A:0x656ab304
y.create.l HWIO_PBCH_REENC_WORD2_DB1_ADDR A:0x656ab308
y.create.l HWIO_W_DBACK_HS_SHARED_WORD0_DB1_ADDR A:0x656ac100
y.create.l HWIO_W_DBACK_HS_SHARED_WORD1_DB1_ADDR A:0x656ac104
y.create.l HWIO_W_DBACK_HS_SHARED_WORD2_DB1_ADDR A:0x656ac108
y.create.l HWIO_W_DBACK_HS_SHARED_WORD3_DB1_ADDR A:0x656ac10c
y.create.l HWIO_W_DBACK_HS_SHARED_WORD4_DB1_ADDR A:0x656ac110
y.create.l HWIO_W_DBACK_HS_SHARED_WORD5_DB1_ADDR A:0x656ac114
y.create.l HWIO_W_DBACK_HS_SHARED_WORD6_DB1_ADDR A:0x656ac118
y.create.l HWIO_W_DBACK_HS_SHARED_WORD7_DB1_ADDR A:0x656ac11c
y.create.l HWIO_W_DBACK_HS_SHARED_WORD8_DB1_ADDR A:0x656ac120
y.create.l HWIO_W_DBACK_HS_SHARED_WORD9_DB1_ADDR A:0x656ac124
y.create.l HWIO_W_DBACK_HS_SHARED_WORD10_DB1_ADDR A:0x656ac128
y.create.l HWIO_W_DBACK_HS_SHARED_WORD11_DB1_ADDR A:0x656ac12c
y.create.l HWIO_W_DBACK_HS_SHARED_WORD12_DB1_ADDR A:0x656ac130
y.create.l HWIO_W_DBACK_HS_SHARED_WORD13_DB1_ADDR A:0x656ac134
y.create.l HWIO_W_DBACK_HS_SHARED_WORD14_DB1_ADDR A:0x656ac138
y.create.l HWIO_W_DBACK_HS_SHARED_WORD15_DB1_ADDR A:0x656ac13c
y.create.l HWIO_W_DBACK_HS_SHARED_WORD16_DB1_ADDR A:0x656ac140
y.create.l HWIO_W_DBACK_HS_SHARED_WORD17_DB1_ADDR A:0x656ac144
y.create.l HWIO_W_DBACK_HS_SHARED_WORD18_DB1_ADDR A:0x656ac148
y.create.l HWIO_W_DBACK_HS_SHARED_WORD19_DB1_ADDR A:0x656ac14c
y.create.l HWIO_W_DBACK_HS_SHARED_WORD20_DB1_ADDR A:0x656ac150
y.create.l HWIO_W_DBACK_HS_SHARED_WORD21_DB1_ADDR A:0x656ac154
y.create.l HWIO_W_DBACK_HS_SHARED_WORD22_DB1_ADDR A:0x656ac158
y.create.l HWIO_W_DBACK_HS_SHARED_WORD23_DB1_ADDR A:0x656ac15c
y.create.l HWIO_W_DBACK_HS_SHARED_WORD24_DB1_ADDR A:0x656ac160
y.create.l HWIO_W_DBACK_HS_SHARED_WORD25_DB1_ADDR A:0x656ac164
y.create.l HWIO_W_DBACK_HS_SHARED_WORD26_DB1_ADDR A:0x656ac168
y.create.l HWIO_W_DBACK_HS_SHARED_WORD27_DB1_ADDR A:0x656ac16c
y.create.l HWIO_W_DBACK_HS_SHARED_WORD28_DB1_ADDR A:0x656ac170
y.create.l HWIO_W_DBACK_HS_SHARED_WORD29_DB1_ADDR A:0x656ac174
y.create.l HWIO_W_DBACK_HS_SHARED_WORD30_DB1_ADDR A:0x656ac178
y.create.l HWIO_W_DBACK_HS_SHARED_WORD31_DB1_ADDR A:0x656ac17c
y.create.l HWIO_W_DBACK_HS_SHARED_WORD32_DB1_ADDR A:0x656ac180
y.create.l HWIO_W_DBACK_HS_SHARED_WORD33_DB1_ADDR A:0x656ac184
y.create.l HWIO_W_DBACK_HS_SHARED_WORD34_DB1_ADDR A:0x656ac188
y.create.l HWIO_W_DBACK_HS_SHARED_WORD35_DB1_ADDR A:0x656ac18c
y.create.l HWIO_W_DBACK_HS_SHARED_WORD36_DB1_ADDR A:0x656ac190
y.create.l HWIO_W_DBACK_HS_SHARED_WORD37_DB1_ADDR A:0x656ac194
y.create.l HWIO_W_DBACK_HS_SHARED_WORD38_DB1_ADDR A:0x656ac198
y.create.l HWIO_W_DBACK_HS_SHARED_WORD39_DB1_ADDR A:0x656ac19c
y.create.l HWIO_W_DBACK_HS_SHARED_WORD40_DB1_ADDR A:0x656ac1a0
y.create.l HWIO_W_DBACK_HS_SHARED_WORD41_DB1_ADDR A:0x656ac1a4
y.create.l HWIO_W_DBACK_HS_SHARED_WORD42_DB1_ADDR A:0x656ac1a8
y.create.l HWIO_W_DBACK_HS_SHARED_WORD43_DB1_ADDR A:0x656ac1ac
y.create.l HWIO_W_DBACK_HS_SHARED_WORD44_DB1_ADDR A:0x656ac1b0
y.create.l HWIO_W_DBACK_HS_SHARED_WORD45_DB1_ADDR A:0x656ac1b4
y.create.l HWIO_W_DBACK_HS_SHARED_WORD46_DB1_ADDR A:0x656ac1b8
y.create.l HWIO_W_DBACK_HS_SHARED_WORD47_DB1_ADDR A:0x656ac1bc
y.create.l HWIO_W_DBACK_HS_SHARED_WORD48_DB1_ADDR A:0x656ac1c0
y.create.l HWIO_W_DBACK_HS_SHARED_WORD49_DB1_ADDR A:0x656ac1c4
y.create.l HWIO_W_DBACK_HS_SHARED_WORD50_DB1_ADDR A:0x656ac1c8
y.create.l HWIO_W_DBACK_HS_SHARED_WORD51_DB1_ADDR A:0x656ac1cc
y.create.l HWIO_W_DBACK_HS_SHARED_WORD52_DB1_ADDR A:0x656ac1d0
y.create.l HWIO_W_DBACK_HS_SHARED_WORD53_DB1_ADDR A:0x656ac1d4
y.create.l HWIO_W_DBACK_HS_SHARED_WORD54_DB1_ADDR A:0x656ac1d8
y.create.l HWIO_W_DBACK_HS_SHARED_WORD55_DB1_ADDR A:0x656ac1dc
y.create.l HWIO_W_DBACK_HS_SHARED_WORD56_DB1_ADDR A:0x656ac1e0
y.create.l HWIO_W_DBACK_HS_SHARED_WORD57_DB1_ADDR A:0x656ac1e4
y.create.l HWIO_W_DBACK_HS_TD_DECIB_WRITER_WORD0_DB1_ADDR A:0x656ac200
y.create.l HWIO_W_DBACK_HS_TD_DECIB_WRITER_CFG_WORD0_DB1_ADDR A:0x656ac300
y.create.l HWIO_W_DBACK_HS_TD_DECIB_WRITER_CFG_WORD1_DB1_ADDR A:0x656ac304
y.create.l HWIO_W_DBACK_HS_TD_DECIB_WRITER_CFG_WORD2_DB1_ADDR A:0x656ac308
y.create.l HWIO_W_DBACK_HS_TD_DECIB_WRITER_CFG_WORD3_DB1_ADDR A:0x656ac30c
y.create.l HWIO_W_DBACK_HS_TD_DECIB_WRITER_CFG_WORD4_DB1_ADDR A:0x656ac310
y.create.l HWIO_W_DBACK_HS_TD_DECIB_WRITER_CFG_WORD5_DB1_ADDR A:0x656ac314
y.create.l HWIO_W_DBACK_HS_TD_DECIB_WRITER_CFG_WORD6_DB1_ADDR A:0x656ac318
y.create.l HWIO_W_DBACK_HS_TD_DECIB_WRITER_CFG_WORD7_DB1_ADDR A:0x656ac31c
y.create.l HWIO_W_DBACK_NONHS_SHARED_WORD0_DB1_ADDR A:0x656ad100
y.create.l HWIO_W_DBACK_NONHS_SHARED_WORD1_DB1_ADDR A:0x656ad104
y.create.l HWIO_W_DBACK_NONHS_SHARED_WORD2_DB1_ADDR A:0x656ad108
y.create.l HWIO_W_DBACK_NONHS_SHARED_WORD3_DB1_ADDR A:0x656ad10c
y.create.l HWIO_W_DBACK_NONHS_SHARED_WORD4_DB1_ADDR A:0x656ad110
y.create.l HWIO_W_DBACK_NONHS_SHARED_WORD5_DB1_ADDR A:0x656ad114
y.create.l HWIO_W_DBACK_NONHS_SHARED_WORD6_DB1_ADDR A:0x656ad118
y.create.l HWIO_W_DBACK_NONHS_SHARED_WORD7_DB1_ADDR A:0x656ad11c
y.create.l HWIO_W_DBACK_NONHS_DRM_CFG_WORD0_DB1_ADDR A:0x656ad200
y.create.l HWIO_W_DBACK_NONHS_DRM_CFG_WORD1_DB1_ADDR A:0x656ad204
y.create.l HWIO_W_DBACK_NONHS_DRM_CFG_WORD2_DB1_ADDR A:0x656ad208
y.create.l HWIO_W_DBACK_NONHS_DRM_CFG_WORD3_DB1_ADDR A:0x656ad20c
y.create.l HWIO_W_DBACK_NONHS_DRM_CFG_WORD4_DB1_ADDR A:0x656ad210
y.create.l HWIO_W_DBACK_NONHS_DRM_CFG_WORD5_DB1_ADDR A:0x656ad214
y.create.l HWIO_W_DBACK_NONHS_DRM_CFG_WORD6_DB1_ADDR A:0x656ad218
y.create.l HWIO_W_DBACK_NONHS_DRM_CFG_WORD7_DB1_ADDR A:0x656ad21c
y.create.l HWIO_W_DBACK_NONHS_DRM_CFG_WORD8_DB1_ADDR A:0x656ad220
y.create.l HWIO_W_DBACK_NONHS_DRM_CFG_WORD9_DB1_ADDR A:0x656ad224
y.create.l HWIO_W_DBACK_NONHS_DRM_CFG_WORD10_DB1_ADDR A:0x656ad228
y.create.l HWIO_W_DBACK_NONHS_DRM_CFG_WORD11_DB1_ADDR A:0x656ad22c
y.create.l HWIO_W_DBACK_NONHS_DRM_CFG_WORD12_DB1_ADDR A:0x656ad230
y.create.l HWIO_W_DBACK_NONHS_DRM_CFG_WORD13_DB1_ADDR A:0x656ad234
y.create.l HWIO_W_DBACK_NONHS_DRM_CFG_WORD14_DB1_ADDR A:0x656ad238
y.create.l HWIO_W_DBACK_NONHS_DRM_CFG_WORD15_DB1_ADDR A:0x656ad23c
y.create.l HWIO_W_DBACK_NONHS_TD_DECIB_WRITER_CFG_WORD0_DB1_ADDR A:0x656ad300
y.create.l HWIO_W_DBACK_NONHS_TD_DECIB_WRITER_CFG_WORD1_DB1_ADDR A:0x656ad304
y.create.l HWIO_T_DBACK_SHARED_WORD0_DB1_ADDR A:0x656ae100
y.create.l HWIO_T_DBACK_SHARED_WORD1_DB1_ADDR A:0x656ae104
y.create.l HWIO_T_DBACK_SHARED_WORD2_DB1_ADDR A:0x656ae108
y.create.l HWIO_T_DBACK_SHARED_WORD3_DB1_ADDR A:0x656ae10c
y.create.l HWIO_T_DBACK_SHARED_WORD4_DB1_ADDR A:0x656ae110
y.create.l HWIO_T_DBACK_SHARED_WORD5_DB1_ADDR A:0x656ae114
y.create.l HWIO_T_DBACK_SHARED_WORD6_DB1_ADDR A:0x656ae118
y.create.l HWIO_T_DBACK_SHARED_WORD7_DB1_ADDR A:0x656ae11c
y.create.l HWIO_T_DBACK_SHARED_WORD8_DB1_ADDR A:0x656ae120
y.create.l HWIO_T_DBACK_SHARED_WORD9_DB1_ADDR A:0x656ae124
y.create.l HWIO_T_DBACK_SHARED_WORD10_DB1_ADDR A:0x656ae128
y.create.l HWIO_T_DBACK_SHARED_WORD11_DB1_ADDR A:0x656ae12c
y.create.l HWIO_T_DBACK_SHARED_WORD12_DB1_ADDR A:0x656ae130
y.create.l HWIO_T_DBACK_SHARED_WORD13_DB1_ADDR A:0x656ae134
y.create.l HWIO_T_DBACK_SHARED_WORD14_DB1_ADDR A:0x656ae138
y.create.l HWIO_T_DBACK_SHARED_WORD15_DB1_ADDR A:0x656ae13c
y.create.l HWIO_T_DBACK_SHARED_WORD16_DB1_ADDR A:0x656ae140
y.create.l HWIO_T_DBACK_SHARED_WORD17_DB1_ADDR A:0x656ae144
y.create.l HWIO_T_DBACK_SHARED_WORD18_DB1_ADDR A:0x656ae148
y.create.l HWIO_T_DBACK_SHARED_WORD19_DB1_ADDR A:0x656ae14c
y.create.l HWIO_T_DBACK_SHARED_WORD20_DB1_ADDR A:0x656ae150
y.create.l HWIO_T_DBACK_SHARED_WORD21_DB1_ADDR A:0x656ae154
y.create.l HWIO_T_DBACK_SHARED_WORD22_DB1_ADDR A:0x656ae158
y.create.l HWIO_T_DBACK_SHARED_WORD23_DB1_ADDR A:0x656ae15c
y.create.l HWIO_T_DBACK_SHARED_WORD24_DB1_ADDR A:0x656ae160
y.create.l HWIO_T_DBACK_SHARED_WORD25_DB1_ADDR A:0x656ae164
y.create.l HWIO_T_DBACK_SHARED_WORD26_DB1_ADDR A:0x656ae168
y.create.l HWIO_T_DBACK_SHARED_WORD27_DB1_ADDR A:0x656ae16c
y.create.l HWIO_T_DBACK_SHARED_WORD28_DB1_ADDR A:0x656ae170
y.create.l HWIO_T_DBACK_SHARED_WORD29_DB1_ADDR A:0x656ae174
y.create.l HWIO_T_DBACK_SHARED_WORD30_DB1_ADDR A:0x656ae178
y.create.l HWIO_T_DBACK_SHARED_WORD31_DB1_ADDR A:0x656ae17c
y.create.l HWIO_T_DBACK_SHARED_WORD32_DB1_ADDR A:0x656ae180
y.create.l HWIO_T_DBACK_SHARED_WORD33_DB1_ADDR A:0x656ae184
y.create.l HWIO_T_DBACK_SHARED_WORD34_DB1_ADDR A:0x656ae188
y.create.l HWIO_T_DBACK_SHARED_WORD35_DB1_ADDR A:0x656ae18c
y.create.l HWIO_T_DBACK_SHARED_WORD36_DB1_ADDR A:0x656ae190
y.create.l HWIO_T_DBACK_SHARED_WORD37_DB1_ADDR A:0x656ae194
y.create.l HWIO_T_DBACK_SHARED_WORD38_DB1_ADDR A:0x656ae198
y.create.l HWIO_T_DBACK_NONHS_DRM_CFG_WORD0_DB1_ADDR A:0x656ae200
y.create.l HWIO_T_DBACK_NONHS_DRM_CFG_WORD1_DB1_ADDR A:0x656ae204
y.create.l HWIO_T_DBACK_NONHS_DRM_CFG_WORD2_DB1_ADDR A:0x656ae208
y.create.l HWIO_T_DBACK_NONHS_DRM_CFG_WORD3_DB1_ADDR A:0x656ae20c
y.create.l HWIO_T_DBACK_NONHS_DRM_CFG_WORD4_DB1_ADDR A:0x656ae210
y.create.l HWIO_T_DBACK_NONHS_DRM_CFG_WORD5_DB1_ADDR A:0x656ae214
y.create.l HWIO_T_DBACK_NONHS_DRM_CFG_WORD6_DB1_ADDR A:0x656ae218
y.create.l HWIO_T_DBACK_NONHS_DRM_CFG_WORD7_DB1_ADDR A:0x656ae21c
y.create.l HWIO_T_DBACK_NONHS_DRM_CFG_WORD8_DB1_ADDR A:0x656ae220
y.create.l HWIO_T_DBACK_NONHS_DRM_CFG_WORD9_DB1_ADDR A:0x656ae224
y.create.l HWIO_T_DBACK_NONHS_DRM_CFG_WORD10_DB1_ADDR A:0x656ae228
y.create.l HWIO_T_DBACK_NONHS_DRM_CFG_WORD11_DB1_ADDR A:0x656ae22c
y.create.l HWIO_T_DBACK_NONHS_DRM_CFG_WORD12_DB1_ADDR A:0x656ae230
y.create.l HWIO_T_DBACK_NONHS_DRM_CFG_WORD13_DB1_ADDR A:0x656ae234
y.create.l HWIO_T_DBACK_NONHS_DRM_CFG_WORD14_DB1_ADDR A:0x656ae238
y.create.l HWIO_T_DBACK_NONHS_DRM_CFG_WORD15_DB1_ADDR A:0x656ae23c
y.create.l HWIO_T_DBACK_NONHS_DRM_CFG_WORD16_DB1_ADDR A:0x656ae240
y.create.l HWIO_T_DBACK_NONHS_DRM_CFG_WORD17_DB1_ADDR A:0x656ae244
y.create.l HWIO_T_DBACK_NONHS_DRM_CFG_WORD18_DB1_ADDR A:0x656ae248
y.create.l HWIO_T_DBACK_NONHS_DRM_CFG_WORD19_DB1_ADDR A:0x656ae24c
y.create.l HWIO_T_DBACK_NONHS_DRM_CFG_WORD20_DB1_ADDR A:0x656ae250
y.create.l HWIO_T_DBACK_NONHS_DRM_CFG_WORD21_DB1_ADDR A:0x656ae254
y.create.l HWIO_T_DBACK_NONHS_DRM_CFG_WORD22_DB1_ADDR A:0x656ae258
y.create.l HWIO_T_DBACK_NONHS_DRM_CFG_WORD23_DB1_ADDR A:0x656ae25c
y.create.l HWIO_T_DBACK_NONHS_DRM_CFG_WORD24_DB1_ADDR A:0x656ae260
y.create.l HWIO_T_DBACK_NONHS_DRM_CFG_WORD25_DB1_ADDR A:0x656ae264
y.create.l HWIO_T_DBACK_NONHS_TD_DECIB_WRITER_CFG_WORD0_DB1_ADDR A:0x656ae300
y.create.l HWIO_T_DBACK_NONHS_TD_DECIB_WRITER_CFG_WORD1_DB1_ADDR A:0x656ae304
y.create.l HWIO_T_DBACK_HS_TD_DECIB_WRITER_CFG_WORD0_DB1_ADDR A:0x656ae400
y.create.l HWIO_T_DBACK_HS_TD_DECIB_WRITER_CFG_WORD1_DB1_ADDR A:0x656ae404
y.create.l HWIO_T_DBACK_HS_TD_DECIB_WRITER_CFG_WORD2_DB1_ADDR A:0x656ae408
y.create.l HWIO_T_DBACK_HS_TD_DECIB_WRITER_CFG_WORD3_DB1_ADDR A:0x656ae40c
y.create.l HWIO_T_DBACK_HS_TD_DECIB_WRITER_CFG_WORD4_DB1_ADDR A:0x656ae410
y.create.l HWIO_T_DBACK_HS_TD_DECIB_WRITER_CFG_WORD5_DB1_ADDR A:0x656ae414
y.create.l HWIO_T_DBACK_HS_TD_DECIB_WRITER_CFG_WORD6_DB1_ADDR A:0x656ae418
y.create.l HWIO_T_DBACK_HS_TD_DECIB_WRITER_CFG_WORD7_DB1_ADDR A:0x656ae41c
y.create.l HWIO_HDR_DEINT_CFG_WORD0_DB1_ADDR A:0x656af100
y.create.l HWIO_HDR_DEINT_CFG_WORD1_DB1_ADDR A:0x656af104
y.create.l HWIO_HDR_DEINT_CFG_WORD2_DB1_ADDR A:0x656af108
y.create.l HWIO_HDR_DEINT_CFG_WORD3_DB1_ADDR A:0x656af10c
y.create.l HWIO_HDR_DEINT_CFG_WORD4_DB1_ADDR A:0x656af110
y.create.l HWIO_HDR_DEINT_CFG_WORD5_DB1_ADDR A:0x656af114
y.create.l HWIO_HDR_DEINT_CFG_WORD6_DB1_ADDR A:0x656af118
y.create.l HWIO_HDR_DEINT_CFG_WORD7_DB1_ADDR A:0x656af11c
y.create.l HWIO_HDR_DEINT_CFG_WORD8_DB1_ADDR A:0x656af120
y.create.l HWIO_HDR_DEINT_CFG_WORD9_DB1_ADDR A:0x656af124
y.create.l HWIO_HDR_DEINT_CFG_WORD10_DB1_ADDR A:0x656af128
y.create.l HWIO_HDR_DEINT_CFG_WORD11_DB1_ADDR A:0x656af12c
y.create.l HWIO_HDR_DEINT_CFG_WORD12_DB1_ADDR A:0x656af130
y.create.l HWIO_HDR_DEINT_CFG_WORD13_DB1_ADDR A:0x656af134
y.create.l HWIO_HDR_DEINT_CFG_WORD14_DB1_ADDR A:0x656af138
y.create.l HWIO_HDR_DEINT_CFG_WORD15_DB1_ADDR A:0x656af13c
y.create.l HWIO_HDR_DEINT_CFG_WORD16_DB1_ADDR A:0x656af140
y.create.l HWIO_HDR_DEINT_WORD0_DB1_ADDR A:0x656af200
y.create.l HWIO_HDR_DEINT_WORD1_DB1_ADDR A:0x656af204
y.create.l HWIO_HDR_DEINT_WORD2_DB1_ADDR A:0x656af208
y.create.l HWIO_HDR_DEINT_WORD3_DB1_ADDR A:0x656af20c
y.create.l HWIO_HDR_DEINT_WORD4_DB1_ADDR A:0x656af210
y.create.l HWIO_HDR_DEINT_WORD5_DB1_ADDR A:0x656af214
y.create.l HWIO_HDR_DEINT_WORD6_DB1_ADDR A:0x656af218
y.create.l HWIO_HDR_DEINT_WORD7_DB1_ADDR A:0x656af21c
y.create.l HWIO_HDR_DEINT_WORD8_DB1_ADDR A:0x656af220
y.create.l HWIO_HDR_DEINT_WORD9_DB1_ADDR A:0x656af224
y.create.l HWIO_HDR_DEINT_WORD10_DB1_ADDR A:0x656af228
y.create.l HWIO_HDR_DEINT_WORD11_DB1_ADDR A:0x656af22c
y.create.l HWIO_HDR_DEINT_WORD12_DB1_ADDR A:0x656af230
y.create.l HWIO_HDR_DEINT_WORD13_DB1_ADDR A:0x656af234
y.create.l HWIO_TBVD_CCH_STATUS_WORD0_DB1_ADDR A:0x656b0000
y.create.l HWIO_TBVD_CCH_LTE_CFG_WORD0_DB1_ADDR A:0x656b0100
y.create.l HWIO_TBVD_CCH_LTE_CFG_WORD1_DB1_ADDR A:0x656b0104
y.create.l HWIO_TBVD_CCH_LTE_CFG_WORD2_DB1_ADDR A:0x656b0108
y.create.l HWIO_TBVD_CCH_LTE_CFG_WORD3_DB1_ADDR A:0x656b010c
y.create.l HWIO_TBVD_CCH_LTE_CFG_WORD4_DB1_ADDR A:0x656b0110
y.create.l HWIO_TBVD_CCH_LTE_CFG_WORD5_DB1_ADDR A:0x656b0114
y.create.l HWIO_TBVD_CCH_LTE_CFG_WORD6_DB1_ADDR A:0x656b0118
y.create.l HWIO_TBVD_CCH_LTE_CFG_WORD7_DB1_ADDR A:0x656b011c
y.create.l HWIO_TBVD_CCH_LTE_CFG_WORD8_DB1_ADDR A:0x656b0120
y.create.l HWIO_TBVD_CCH_LTE_CFG_WORD9_DB1_ADDR A:0x656b0124
y.create.l HWIO_TBVD_CCH_LTE_CFG_WORD10_DB1_ADDR A:0x656b0128
y.create.l HWIO_TBVD_CCH_LTE_CFG_WORD11_DB1_ADDR A:0x656b012c
y.create.l HWIO_TBVD_CCH_LTE_CFG_WORD12_DB1_ADDR A:0x656b0130
y.create.l HWIO_TBVD_CCH_LTE_CFG_WORD13_DB1_ADDR A:0x656b0134
y.create.l HWIO_TBVD_CCH_LTE_CFG_WORD14_DB1_ADDR A:0x656b0138
y.create.l HWIO_TBVD_CCH_LTE_CFG_WORD15_DB1_ADDR A:0x656b013c
y.create.l HWIO_TBVD_CCH_LTE_CFG_WORD16_DB1_ADDR A:0x656b0140
y.create.l HWIO_TBVD_CCH_LTE_CFG_WORD17_DB1_ADDR A:0x656b0144
y.create.l HWIO_TBVD_CCH_LTE_CFG_WORD18_DB1_ADDR A:0x656b0148
y.create.l HWIO_TBVD_CCH_LTE_CFG_WORD19_DB1_ADDR A:0x656b014c
y.create.l HWIO_TBVD_CCH_LTE_PDCCH_WORD0_DB1_ADDR A:0x656b0200
y.create.l HWIO_TBVD_CCH_LTE_PDCCH_WORD1_DB1_ADDR A:0x656b0204
y.create.l HWIO_TBVD_CCH_LTE_PDCCH_WORD2_DB1_ADDR A:0x656b0208
y.create.l HWIO_TBVD_CCH_LTE_PDCCH_WORD3_DB1_ADDR A:0x656b020c
y.create.l HWIO_TBVD_CCH_LTE_PDCCH_WORD4_DB1_ADDR A:0x656b0210
y.create.l HWIO_TBVD_CCH_LTE_PDCCH_WORD5_DB1_ADDR A:0x656b0214
y.create.l HWIO_TBVD_CCH_LTE_PDCCH_WORD6_DB1_ADDR A:0x656b0218
y.create.l HWIO_DEC_O_CCH_W_NONHS_LTE_PBCH_WORD0_DB1_ADDR A:0x656b0300
y.create.l HWIO_DEC_O_CCH_W_NONHS_LTE_PBCH_WORD1_DB1_ADDR A:0x656b0304
y.create.l HWIO_DEC_O_CCH_W_NONHS_LTE_PBCH_WORD2_DB1_ADDR A:0x656b0308
y.create.l HWIO_DEMBACK_ENABLE_DB1_ADDR A:0x656b4000
y.create.l HWIO_DEMBACK_BUFF_MODE_DB1_ADDR A:0x656b4004
y.create.l HWIO_DEMBACK_BUFF_MEM_CMD_DB1_ADDR A:0x656b4010
y.create.l HWIO_DEMBACK_BUFF_MEM_WR_DB1_ADDR A:0x656b4014
y.create.l HWIO_DEMBACK_BUFF_MEM_RD_DB1_ADDR A:0x656b4018
y.create.l HWIO_DEMBACK_BUFF_TBVD_DECOB_RD_MIN_DB1_ADDR A:0x656b5000
y.create.l HWIO_DEMBACK_BUFF_TBVD_DECOB_RD_MAX_DB1_ADDR A:0x656b577c
y.create.l HWIO_DEMBACK_BUFF_SVD_DECOB_RD_MIN_DB1_ADDR A:0x656b6000
y.create.l HWIO_DEMBACK_BUFF_SVD_DECOB_RD_MAX_DB1_ADDR A:0x656b6d7c
y.create.l HWIO_MSS_MODEM_DTR_PLL1_MODE_ADDR A:0x65700000
y.create.l HWIO_MSS_MODEM_DTR_PLL1_L_VAL_ADDR A:0x65700008
y.create.l HWIO_MSS_MODEM_DTR_PLL1_ALPHA_VAL_L_ADDR A:0x65700010
y.create.l HWIO_MSS_MODEM_DTR_PLL1_ALPHA_VAL_H_ADDR A:0x65700018
y.create.l HWIO_MSS_MODEM_DTR_PLL1_USER_CTL_ADDR A:0x65700020
y.create.l HWIO_MSS_MODEM_DTR_PLL1_CONFIG_CTL_ADDR A:0x65700028
y.create.l HWIO_MSS_MODEM_DTR_PLL1_TEST_CTL_ADDR A:0x65700030
y.create.l HWIO_MSS_MODEM_DTR_PLL1_STATUS_ADDR A:0x65700038
y.create.l HWIO_MSS_MODEM_DTR_PLL2_MODE_ADDR A:0x65700040
y.create.l HWIO_MSS_MODEM_DTR_PLL2_L_VAL_ADDR A:0x65700048
y.create.l HWIO_MSS_MODEM_DTR_PLL2_ALPHA_VAL_L_ADDR A:0x65700050
y.create.l HWIO_MSS_MODEM_DTR_PLL2_ALPHA_VAL_H_ADDR A:0x65700058
y.create.l HWIO_MSS_MODEM_DTR_PLL2_USER_CTL_ADDR A:0x65700060
y.create.l HWIO_MSS_MODEM_DTR_PLL2_CONFIG_CTL_ADDR A:0x65700068
y.create.l HWIO_MSS_MODEM_DTR_PLL2_TEST_CTL_ADDR A:0x65700070
y.create.l HWIO_MSS_MODEM_DTR_PLL2_STATUS_ADDR A:0x65700078
y.create.l HWIO_ADC_TEST_CFG_REG_ADDR A:0x65700198
y.create.l HWIO_DAC_CLK_CFG_ADDR A:0x657001a0
y.create.l HWIO_EXT_GPIO_SEL_CFG_ADDR A:0x657001a8
y.create.l HWIO_CLK_XO_GATE_CFG_ADDR A:0x657001b0
y.create.l HWIO_DBG_CLK_SEL_CFG_ADDR A:0x657001b8
y.create.l HWIO_ADC0_CLK_CFG_ADDR A:0x657001c0
y.create.l HWIO_ADC1_CLK_CFG_ADDR A:0x657001c8
y.create.l HWIO_ADC2_CLK_CFG_ADDR A:0x657001d0
y.create.l HWIO_ADC3_CLK_CFG_ADDR A:0x657001d8
y.create.l HWIO_ADC4_CLK_CFG_ADDR A:0x657001e0
y.create.l HWIO_ADC5_CLK_CFG_ADDR A:0x657001e8
y.create.l HWIO_ADC6_CLK_CFG_ADDR A:0x657001f0
y.create.l HWIO_ADC0_TEST1_REG_ADDR A:0x657001f8
y.create.l HWIO_ADC1_TEST1_REG_ADDR A:0x65700200
y.create.l HWIO_ADC2_TEST1_REG_ADDR A:0x65700208
y.create.l HWIO_ADC3_TEST1_REG_ADDR A:0x65700210
y.create.l HWIO_ADC4_TEST1_REG_ADDR A:0x65700218
y.create.l HWIO_ADC5_TEST1_REG_ADDR A:0x65700220
y.create.l HWIO_ADC6_TEST1_REG_ADDR A:0x65700228
y.create.l HWIO_ADC0_TEST2_REG_ADDR A:0x65700230
y.create.l HWIO_ADC1_TEST2_REG_ADDR A:0x65700238
y.create.l HWIO_ADC2_TEST2_REG_ADDR A:0x65700240
y.create.l HWIO_ADC3_TEST2_REG_ADDR A:0x65700248
y.create.l HWIO_ADC4_TEST2_REG_ADDR A:0x65700250
y.create.l HWIO_ADC5_TEST2_REG_ADDR A:0x65700258
y.create.l HWIO_ADC6_TEST2_REG_ADDR A:0x65700260
y.create.l HWIO_ADC0_TEST3_REG_ADDR A:0x65700268
y.create.l HWIO_ADC1_TEST3_REG_ADDR A:0x65700270
y.create.l HWIO_ADC2_TEST3_REG_ADDR A:0x65700278
y.create.l HWIO_ADC3_TEST3_REG_ADDR A:0x65700280
y.create.l HWIO_ADC4_TEST3_REG_ADDR A:0x65700288
y.create.l HWIO_ADC5_TEST3_REG_ADDR A:0x65700290
y.create.l HWIO_ADC6_TEST3_REG_ADDR A:0x65700298
y.create.l HWIO_ADC0_CONFIG_REG_ADDR A:0x657002a0
y.create.l HWIO_ADC1_CONFIG_REG_ADDR A:0x657002a8
y.create.l HWIO_ADC2_CONFIG_REG_ADDR A:0x657002b0
y.create.l HWIO_ADC3_CONFIG_REG_ADDR A:0x657002b8
y.create.l HWIO_ADC4_CONFIG_REG_ADDR A:0x657002c0
y.create.l HWIO_ADC5_CONFIG_REG_ADDR A:0x657002c8
y.create.l HWIO_ADC6_CONFIG_REG_ADDR A:0x657002d0
y.create.l HWIO_ADC0_CONFIG2_REG_ADDR A:0x657002d8
y.create.l HWIO_ADC1_CONFIG2_REG_ADDR A:0x657002e0
y.create.l HWIO_ADC2_CONFIG2_REG_ADDR A:0x657002e8
y.create.l HWIO_ADC3_CONFIG2_REG_ADDR A:0x657002f0
y.create.l HWIO_ADC4_CONFIG2_REG_ADDR A:0x657002f8
y.create.l HWIO_ADC5_CONFIG2_REG_ADDR A:0x65700300
y.create.l HWIO_ADC6_CONFIG2_REG_ADDR A:0x65700308
y.create.l HWIO_ADC0_CONTROL_REG_ADDR A:0x65700310
y.create.l HWIO_ADC1_CONTROL_REG_ADDR A:0x65700318
y.create.l HWIO_ADC2_CONTROL_REG_ADDR A:0x65700320
y.create.l HWIO_ADC3_CONTROL_REG_ADDR A:0x65700328
y.create.l HWIO_ADC4_CONTROL_REG_ADDR A:0x65700330
y.create.l HWIO_ADC5_CONTROL_REG_ADDR A:0x65700338
y.create.l HWIO_ADC6_CONTROL_REG_ADDR A:0x65700340
y.create.l HWIO_ADC0_CONFIG3_REG_ADDR A:0x65700348
y.create.l HWIO_ADC1_CONFIG3_REG_ADDR A:0x65700350
y.create.l HWIO_ADC2_CONFIG3_REG_ADDR A:0x65700358
y.create.l HWIO_ADC3_CONFIG3_REG_ADDR A:0x65700360
y.create.l HWIO_ADC4_CONFIG3_REG_ADDR A:0x65700368
y.create.l HWIO_ADC5_CONFIG3_REG_ADDR A:0x65700370
y.create.l HWIO_ADC6_CONFIG3_REG_ADDR A:0x65700378
y.create.l HWIO_RXFE_ENABLE_ADDR A:0x65708000
y.create.l HWIO_RXFE_TOP_STATUS_ADDR A:0x65708054
y.create.l HWIO_RXFE_RFIF_UPDATE_CMD_ADDR A:0x65708058
y.create.l HWIO_RXFE_CMNNOTCH_FILT0_CFG0_ADDR A:0x6570805c
y.create.l HWIO_RXFE_CMNNOTCH_FILT0_CFG1_ADDR A:0x65708060
y.create.l HWIO_RXFE_CMNNOTCH_FILT1_CFG0_ADDR A:0x65708064
y.create.l HWIO_RXFE_CMNNOTCH_FILT1_CFG1_ADDR A:0x65708068
y.create.l HWIO_RXFE_CMNNOTCH_FILT2_CFG0_ADDR A:0x6570806c
y.create.l HWIO_RXFE_CMNNOTCH_FILT2_CFG1_ADDR A:0x65708070
y.create.l HWIO_RXFE_CMNNOTCH_FILT3_CFG0_ADDR A:0x65708074
y.create.l HWIO_RXFE_CMNNOTCH_FILT3_CFG1_ADDR A:0x65708078
y.create.l HWIO_RXFE_CMNNOTCH_FILT01_CFG_ADDR A:0x6570807c
y.create.l HWIO_RXFE_CMNNOTCH_FILT23_CFG_ADDR A:0x65708080
y.create.l HWIO_RXFE_ACI_FILT0_CFG_ADDR A:0x65708084
y.create.l HWIO_RXFE_ACI_FILT1_CFG_ADDR A:0x65708088
y.create.l HWIO_RXFE_DBG_ENABLES_ADDR A:0x6570808c
y.create.l HWIO_RXFE_DBG_PROBE_CTL_ADDR A:0x65708090
y.create.l HWIO_RXFE_DBG_CMD_ADDR A:0x65708094
y.create.l HWIO_RXFE_PBS_CFG_ADDR A:0x65708098
y.create.l HWIO_RXFE_TOP_SPARE_REG_ADDR A:0x657080a4
y.create.l HWIO_RXFE_ADC0_LOGIC_CFG_ADDR A:0x657080a8
y.create.l HWIO_RXFE_ADC1_LOGIC_CFG_ADDR A:0x657080ac
y.create.l HWIO_RXFE_ADC2_LOGIC_CFG_ADDR A:0x657080b0
y.create.l HWIO_RXFE_ADC3_LOGIC_CFG_ADDR A:0x657080b4
y.create.l HWIO_RXFE_ADC4_LOGIC_CFG_ADDR A:0x657080b8
y.create.l HWIO_RXFE_ADC5_LOGIC_CFG_ADDR A:0x657080bc
y.create.l HWIO_RXFE_ADC6_LOGIC_CFG_ADDR A:0x657080c0
y.create.l HWIO_RXFE_WB0_ADCMUX_CFG_ADDR A:0x657080c8
y.create.l HWIO_RXFE_WB1_ADCMUX_CFG_ADDR A:0x657080cc
y.create.l HWIO_RXFE_WB2_ADCMUX_CFG_ADDR A:0x657080d0
y.create.l HWIO_RXFE_WB3_ADCMUX_CFG_ADDR A:0x657080d4
y.create.l HWIO_RXFE_WB4_ADCMUX_CFG_ADDR A:0x657080d8
y.create.l HWIO_RXFE_WB5_ADCMUX_CFG_ADDR A:0x657080dc
y.create.l HWIO_RXFE_WB6_ADCMUX_CFG_ADDR A:0x657080e0
y.create.l HWIO_RXFE_NB0_WBMUX_CFG_ADDR A:0x657080e4
y.create.l HWIO_RXFE_NB1_WBMUX_CFG_ADDR A:0x657080e8
y.create.l HWIO_RXFE_NB2_WBMUX_CFG_ADDR A:0x657080ec
y.create.l HWIO_RXFE_NB3_WBMUX_CFG_ADDR A:0x657080f0
y.create.l HWIO_RXFE_NB4_WBMUX_CFG_ADDR A:0x657080f4
y.create.l HWIO_RXFE_NB5_WBMUX_CFG_ADDR A:0x657080f8
y.create.l HWIO_RXFE_NB6_WBMUX_CFG_ADDR A:0x657080fc
y.create.l HWIO_RXFE_NB7_WBMUX_CFG_ADDR A:0x65708100
y.create.l HWIO_RXFE_NB8_WBMUX_CFG_ADDR A:0x65708104
y.create.l HWIO_RXFE_NB9_WBMUX_CFG_ADDR A:0x65708108
y.create.l HWIO_RXFE_WB_TOP_CTL_WB0_ADDR A:0x65710000
y.create.l HWIO_RXFE_WB_TOP_CMD_WB0_ADDR A:0x65710004
y.create.l HWIO_RXFE_WB_TOP_STATUS_WB0_ADDR A:0x65710008
y.create.l HWIO_RXFE_WB_STOPGATE_ACTION_SAMPLE_WB0_ADDR A:0x6571000c
y.create.l HWIO_RXFE_WB_TIMINGCTL_STATUS_WB0_ADDR A:0x65710010
y.create.l HWIO_RXFE_WB_MISC_CFG_WB0_ADDR A:0x65710014
y.create.l HWIO_RXFE_WB_WBPWR_CFG_WB0_ADDR A:0x65710018
y.create.l HWIO_RXFE_WB_WBPWR_CMD_WB0_ADDR A:0x6571001c
y.create.l HWIO_RXFE_WB_WBPWR_START_ACTION_SAMPLE_WB0_ADDR A:0x65710020
y.create.l HWIO_RXFE_WB_WBPWR_START_MASK_WB0_ADDR A:0x65710024
y.create.l HWIO_RXFE_WB_WBPWR_STOP_ACTION_SAMPLE_WB0_ADDR A:0x65710028
y.create.l HWIO_RXFE_WB_WBPWR_FINAL_ACC_WB0_ADDR A:0x6571002c
y.create.l HWIO_RXFE_WB_WBPWR_CURR_ACC_WB0_ADDR A:0x65710030
y.create.l HWIO_RXFE_WB_WBPWR_MAX_ACC_WB0_ADDR A:0x65710034
y.create.l HWIO_RXFE_WB_WBDC_CFG_WB0_ADDR A:0x65710038
y.create.l HWIO_RXFE_WB_WBDC_CMD_WB0_ADDR A:0x6571003c
y.create.l HWIO_RXFE_WB_WBDC_START_ACTION_SAMPLE_WB0_ADDR A:0x65710040
y.create.l HWIO_RXFE_WB_WBDC_STOP_ACTION_SAMPLE_WB0_ADDR A:0x65710044
y.create.l HWIO_RXFE_WB_WBDC_UPDATE_ACTION_SAMPLE_WB0_ADDR A:0x65710048
y.create.l HWIO_RXFE_WB_WBDC_UPDATE_DELAY_WB0_ADDR A:0x6571004c
y.create.l HWIO_RXFE_WB_WBDC_OVRD_I_WB0_ADDR A:0x65710050
y.create.l HWIO_RXFE_WB_WBDC_OVRD_Q_WB0_ADDR A:0x65710054
y.create.l HWIO_RXFE_WB_WBDC_EST1_CURR_I_WB0_ADDR A:0x65710058
y.create.l HWIO_RXFE_WB_WBDC_EST1_CURR_Q_WB0_ADDR A:0x6571005c
y.create.l HWIO_RXFE_WB_WBDC_EST1_PREV_I_WB0_ADDR A:0x65710060
y.create.l HWIO_RXFE_WB_WBDC_EST1_PREV_Q_WB0_ADDR A:0x65710064
y.create.l HWIO_RXFE_WB_WBDC_EST1_LOAD_I_WB0_ADDR A:0x65710068
y.create.l HWIO_RXFE_WB_WBDC_EST1_LOAD_Q_WB0_ADDR A:0x6571006c
y.create.l HWIO_RXFE_WB_WBDC_EST2_CURR_I_WB0_ADDR A:0x65710070
y.create.l HWIO_RXFE_WB_WBDC_EST2_CURR_Q_WB0_ADDR A:0x65710074
y.create.l HWIO_RXFE_WB_WBDC_EST2_PREV_I_WB0_ADDR A:0x65710078
y.create.l HWIO_RXFE_WB_WBDC_EST2_PREV_Q_WB0_ADDR A:0x6571007c
y.create.l HWIO_RXFE_WB_WBDC_EST2_LOAD_I_WB0_ADDR A:0x65710080
y.create.l HWIO_RXFE_WB_WBDC_EST2_LOAD_Q_WB0_ADDR A:0x65710084
y.create.l HWIO_RXFE_WB_VSRC_CFG_WB0_ADDR A:0x65710088
y.create.l HWIO_RXFE_WB_VSRC_T2BYT1M1_WB0_ADDR A:0x6571008c
y.create.l HWIO_RXFE_WB_VSRC_CMD_WB0_ADDR A:0x65710090
y.create.l HWIO_RXFE_WB_VSRC_STATUS_WB0_ADDR A:0x65710094
y.create.l HWIO_RXFE_WB_VSRC_UPDT_ACTION_SAMPLE_WB0_ADDR A:0x65710098
y.create.l HWIO_RXFE_WB_VSRC_CURR_T1BYT2_WB0_ADDR A:0x6571009c
y.create.l HWIO_RXFE_WB_VSRC_CURR_T2BYT1M1_WB0_ADDR A:0x657100a0
y.create.l HWIO_RXFE_WB_VSRC_SCTR_LOAD_VALUE_WB0_ADDR A:0x657100a4
y.create.l HWIO_RXFE_WB_VSRC_SCTR_WA_WB0_ADDR A:0x657100a8
y.create.l HWIO_RXFE_WB_VSRC_SCTR_SNAPSHOT_WB0_ADDR A:0x657100ac
y.create.l HWIO_RXFE_WB_VSRC_ACC_SNAPSHOT_WB0_ADDR A:0x657100b0
y.create.l HWIO_RXFE_WB_DEC_FILT_CFG_WB0_ADDR A:0x657100b4
y.create.l HWIO_RXFE_WB_IQMC_CFG0_WB0_ADDR A:0x657100b8
y.create.l HWIO_RXFE_WB_IQMC_CFG1_WB0_ADDR A:0x657100bc
y.create.l HWIO_RXFE_WB_IQMC_CURR_VALS_WB0_ADDR A:0x657100c0
y.create.l HWIO_RXFE_WB_IQMC_UPDT_CMD_WB0_ADDR A:0x657100c4
y.create.l HWIO_RXFE_WB_IQMC_UPDT_ACTION_SAMPLE_WB0_ADDR A:0x657100c8
y.create.l HWIO_RXFE_WB_NOTCH_FILT0_CFG0_WB0_ADDR A:0x657100cc
y.create.l HWIO_RXFE_WB_NOTCH_FILT1_CFG0_WB0_ADDR A:0x657100d0
y.create.l HWIO_RXFE_WB_NOTCH_FILT2_CFG0_WB0_ADDR A:0x657100d4
y.create.l HWIO_RXFE_WB_NOTCH_FILT3_CFG0_WB0_ADDR A:0x657100d8
y.create.l HWIO_RXFE_WB_NOTCH_FILT0_CFG1_WB0_ADDR A:0x657100dc
y.create.l HWIO_RXFE_WB_NOTCH_FILT1_CFG1_WB0_ADDR A:0x657100e0
y.create.l HWIO_RXFE_WB_NOTCH_FILT2_CFG1_WB0_ADDR A:0x657100e4
y.create.l HWIO_RXFE_WB_NOTCH_FILT3_CFG1_WB0_ADDR A:0x657100e8
y.create.l HWIO_RXFE_WB_NOTCH_FILT01_CFG_WB0_ADDR A:0x657100f0
y.create.l HWIO_RXFE_WB_NOTCH_FILT23_CFG_WB0_ADDR A:0x657100f4
y.create.l HWIO_RXFE_WB_SPARE_REG_WB0_ADDR A:0x657100f8
y.create.l HWIO_RXFE_WB_TOP_CTL_WB1_ADDR A:0x65718000
y.create.l HWIO_RXFE_WB_TOP_CMD_WB1_ADDR A:0x65718004
y.create.l HWIO_RXFE_WB_TOP_STATUS_WB1_ADDR A:0x65718008
y.create.l HWIO_RXFE_WB_STOPGATE_ACTION_SAMPLE_WB1_ADDR A:0x6571800c
y.create.l HWIO_RXFE_WB_TIMINGCTL_STATUS_WB1_ADDR A:0x65718010
y.create.l HWIO_RXFE_WB_MISC_CFG_WB1_ADDR A:0x65718014
y.create.l HWIO_RXFE_WB_WBPWR_CFG_WB1_ADDR A:0x65718018
y.create.l HWIO_RXFE_WB_WBPWR_CMD_WB1_ADDR A:0x6571801c
y.create.l HWIO_RXFE_WB_WBPWR_START_ACTION_SAMPLE_WB1_ADDR A:0x65718020
y.create.l HWIO_RXFE_WB_WBPWR_START_MASK_WB1_ADDR A:0x65718024
y.create.l HWIO_RXFE_WB_WBPWR_STOP_ACTION_SAMPLE_WB1_ADDR A:0x65718028
y.create.l HWIO_RXFE_WB_WBPWR_FINAL_ACC_WB1_ADDR A:0x6571802c
y.create.l HWIO_RXFE_WB_WBPWR_CURR_ACC_WB1_ADDR A:0x65718030
y.create.l HWIO_RXFE_WB_WBPWR_MAX_ACC_WB1_ADDR A:0x65718034
y.create.l HWIO_RXFE_WB_WBDC_CFG_WB1_ADDR A:0x65718038
y.create.l HWIO_RXFE_WB_WBDC_CMD_WB1_ADDR A:0x6571803c
y.create.l HWIO_RXFE_WB_WBDC_START_ACTION_SAMPLE_WB1_ADDR A:0x65718040
y.create.l HWIO_RXFE_WB_WBDC_STOP_ACTION_SAMPLE_WB1_ADDR A:0x65718044
y.create.l HWIO_RXFE_WB_WBDC_UPDATE_ACTION_SAMPLE_WB1_ADDR A:0x65718048
y.create.l HWIO_RXFE_WB_WBDC_UPDATE_DELAY_WB1_ADDR A:0x6571804c
y.create.l HWIO_RXFE_WB_WBDC_OVRD_I_WB1_ADDR A:0x65718050
y.create.l HWIO_RXFE_WB_WBDC_OVRD_Q_WB1_ADDR A:0x65718054
y.create.l HWIO_RXFE_WB_WBDC_EST1_CURR_I_WB1_ADDR A:0x65718058
y.create.l HWIO_RXFE_WB_WBDC_EST1_CURR_Q_WB1_ADDR A:0x6571805c
y.create.l HWIO_RXFE_WB_WBDC_EST1_PREV_I_WB1_ADDR A:0x65718060
y.create.l HWIO_RXFE_WB_WBDC_EST1_PREV_Q_WB1_ADDR A:0x65718064
y.create.l HWIO_RXFE_WB_WBDC_EST1_LOAD_I_WB1_ADDR A:0x65718068
y.create.l HWIO_RXFE_WB_WBDC_EST1_LOAD_Q_WB1_ADDR A:0x6571806c
y.create.l HWIO_RXFE_WB_WBDC_EST2_CURR_I_WB1_ADDR A:0x65718070
y.create.l HWIO_RXFE_WB_WBDC_EST2_CURR_Q_WB1_ADDR A:0x65718074
y.create.l HWIO_RXFE_WB_WBDC_EST2_PREV_I_WB1_ADDR A:0x65718078
y.create.l HWIO_RXFE_WB_WBDC_EST2_PREV_Q_WB1_ADDR A:0x6571807c
y.create.l HWIO_RXFE_WB_WBDC_EST2_LOAD_I_WB1_ADDR A:0x65718080
y.create.l HWIO_RXFE_WB_WBDC_EST2_LOAD_Q_WB1_ADDR A:0x65718084
y.create.l HWIO_RXFE_WB_VSRC_CFG_WB1_ADDR A:0x65718088
y.create.l HWIO_RXFE_WB_VSRC_T2BYT1M1_WB1_ADDR A:0x6571808c
y.create.l HWIO_RXFE_WB_VSRC_CMD_WB1_ADDR A:0x65718090
y.create.l HWIO_RXFE_WB_VSRC_STATUS_WB1_ADDR A:0x65718094
y.create.l HWIO_RXFE_WB_VSRC_UPDT_ACTION_SAMPLE_WB1_ADDR A:0x65718098
y.create.l HWIO_RXFE_WB_VSRC_CURR_T1BYT2_WB1_ADDR A:0x6571809c
y.create.l HWIO_RXFE_WB_VSRC_CURR_T2BYT1M1_WB1_ADDR A:0x657180a0
y.create.l HWIO_RXFE_WB_VSRC_SCTR_LOAD_VALUE_WB1_ADDR A:0x657180a4
y.create.l HWIO_RXFE_WB_VSRC_SCTR_WA_WB1_ADDR A:0x657180a8
y.create.l HWIO_RXFE_WB_VSRC_SCTR_SNAPSHOT_WB1_ADDR A:0x657180ac
y.create.l HWIO_RXFE_WB_VSRC_ACC_SNAPSHOT_WB1_ADDR A:0x657180b0
y.create.l HWIO_RXFE_WB_DEC_FILT_CFG_WB1_ADDR A:0x657180b4
y.create.l HWIO_RXFE_WB_IQMC_CFG0_WB1_ADDR A:0x657180b8
y.create.l HWIO_RXFE_WB_IQMC_CFG1_WB1_ADDR A:0x657180bc
y.create.l HWIO_RXFE_WB_IQMC_CURR_VALS_WB1_ADDR A:0x657180c0
y.create.l HWIO_RXFE_WB_IQMC_UPDT_CMD_WB1_ADDR A:0x657180c4
y.create.l HWIO_RXFE_WB_IQMC_UPDT_ACTION_SAMPLE_WB1_ADDR A:0x657180c8
y.create.l HWIO_RXFE_WB_NOTCH_FILT0_CFG0_WB1_ADDR A:0x657180cc
y.create.l HWIO_RXFE_WB_NOTCH_FILT1_CFG0_WB1_ADDR A:0x657180d0
y.create.l HWIO_RXFE_WB_NOTCH_FILT2_CFG0_WB1_ADDR A:0x657180d4
y.create.l HWIO_RXFE_WB_NOTCH_FILT3_CFG0_WB1_ADDR A:0x657180d8
y.create.l HWIO_RXFE_WB_NOTCH_FILT0_CFG1_WB1_ADDR A:0x657180dc
y.create.l HWIO_RXFE_WB_NOTCH_FILT1_CFG1_WB1_ADDR A:0x657180e0
y.create.l HWIO_RXFE_WB_NOTCH_FILT2_CFG1_WB1_ADDR A:0x657180e4
y.create.l HWIO_RXFE_WB_NOTCH_FILT3_CFG1_WB1_ADDR A:0x657180e8
y.create.l HWIO_RXFE_WB_NOTCH_FILT01_CFG_WB1_ADDR A:0x657180f0
y.create.l HWIO_RXFE_WB_NOTCH_FILT23_CFG_WB1_ADDR A:0x657180f4
y.create.l HWIO_RXFE_WB_SPARE_REG_WB1_ADDR A:0x657180f8
y.create.l HWIO_RXFE_WB_TOP_CTL_WB2_ADDR A:0x65720000
y.create.l HWIO_RXFE_WB_TOP_CMD_WB2_ADDR A:0x65720004
y.create.l HWIO_RXFE_WB_TOP_STATUS_WB2_ADDR A:0x65720008
y.create.l HWIO_RXFE_WB_STOPGATE_ACTION_SAMPLE_WB2_ADDR A:0x6572000c
y.create.l HWIO_RXFE_WB_TIMINGCTL_STATUS_WB2_ADDR A:0x65720010
y.create.l HWIO_RXFE_WB_MISC_CFG_WB2_ADDR A:0x65720014
y.create.l HWIO_RXFE_WB_WBPWR_CFG_WB2_ADDR A:0x65720018
y.create.l HWIO_RXFE_WB_WBPWR_CMD_WB2_ADDR A:0x6572001c
y.create.l HWIO_RXFE_WB_WBPWR_START_ACTION_SAMPLE_WB2_ADDR A:0x65720020
y.create.l HWIO_RXFE_WB_WBPWR_START_MASK_WB2_ADDR A:0x65720024
y.create.l HWIO_RXFE_WB_WBPWR_STOP_ACTION_SAMPLE_WB2_ADDR A:0x65720028
y.create.l HWIO_RXFE_WB_WBPWR_FINAL_ACC_WB2_ADDR A:0x6572002c
y.create.l HWIO_RXFE_WB_WBPWR_CURR_ACC_WB2_ADDR A:0x65720030
y.create.l HWIO_RXFE_WB_WBPWR_MAX_ACC_WB2_ADDR A:0x65720034
y.create.l HWIO_RXFE_WB_WBDC_CFG_WB2_ADDR A:0x65720038
y.create.l HWIO_RXFE_WB_WBDC_CMD_WB2_ADDR A:0x6572003c
y.create.l HWIO_RXFE_WB_WBDC_START_ACTION_SAMPLE_WB2_ADDR A:0x65720040
y.create.l HWIO_RXFE_WB_WBDC_STOP_ACTION_SAMPLE_WB2_ADDR A:0x65720044
y.create.l HWIO_RXFE_WB_WBDC_UPDATE_ACTION_SAMPLE_WB2_ADDR A:0x65720048
y.create.l HWIO_RXFE_WB_WBDC_UPDATE_DELAY_WB2_ADDR A:0x6572004c
y.create.l HWIO_RXFE_WB_WBDC_OVRD_I_WB2_ADDR A:0x65720050
y.create.l HWIO_RXFE_WB_WBDC_OVRD_Q_WB2_ADDR A:0x65720054
y.create.l HWIO_RXFE_WB_WBDC_EST1_CURR_I_WB2_ADDR A:0x65720058
y.create.l HWIO_RXFE_WB_WBDC_EST1_CURR_Q_WB2_ADDR A:0x6572005c
y.create.l HWIO_RXFE_WB_WBDC_EST1_PREV_I_WB2_ADDR A:0x65720060
y.create.l HWIO_RXFE_WB_WBDC_EST1_PREV_Q_WB2_ADDR A:0x65720064
y.create.l HWIO_RXFE_WB_WBDC_EST1_LOAD_I_WB2_ADDR A:0x65720068
y.create.l HWIO_RXFE_WB_WBDC_EST1_LOAD_Q_WB2_ADDR A:0x6572006c
y.create.l HWIO_RXFE_WB_WBDC_EST2_CURR_I_WB2_ADDR A:0x65720070
y.create.l HWIO_RXFE_WB_WBDC_EST2_CURR_Q_WB2_ADDR A:0x65720074
y.create.l HWIO_RXFE_WB_WBDC_EST2_PREV_I_WB2_ADDR A:0x65720078
y.create.l HWIO_RXFE_WB_WBDC_EST2_PREV_Q_WB2_ADDR A:0x6572007c
y.create.l HWIO_RXFE_WB_WBDC_EST2_LOAD_I_WB2_ADDR A:0x65720080
y.create.l HWIO_RXFE_WB_WBDC_EST2_LOAD_Q_WB2_ADDR A:0x65720084
y.create.l HWIO_RXFE_WB_VSRC_CFG_WB2_ADDR A:0x65720088
y.create.l HWIO_RXFE_WB_VSRC_T2BYT1M1_WB2_ADDR A:0x6572008c
y.create.l HWIO_RXFE_WB_VSRC_CMD_WB2_ADDR A:0x65720090
y.create.l HWIO_RXFE_WB_VSRC_STATUS_WB2_ADDR A:0x65720094
y.create.l HWIO_RXFE_WB_VSRC_UPDT_ACTION_SAMPLE_WB2_ADDR A:0x65720098
y.create.l HWIO_RXFE_WB_VSRC_CURR_T1BYT2_WB2_ADDR A:0x6572009c
y.create.l HWIO_RXFE_WB_VSRC_CURR_T2BYT1M1_WB2_ADDR A:0x657200a0
y.create.l HWIO_RXFE_WB_VSRC_SCTR_LOAD_VALUE_WB2_ADDR A:0x657200a4
y.create.l HWIO_RXFE_WB_VSRC_SCTR_WA_WB2_ADDR A:0x657200a8
y.create.l HWIO_RXFE_WB_VSRC_SCTR_SNAPSHOT_WB2_ADDR A:0x657200ac
y.create.l HWIO_RXFE_WB_VSRC_ACC_SNAPSHOT_WB2_ADDR A:0x657200b0
y.create.l HWIO_RXFE_WB_DEC_FILT_CFG_WB2_ADDR A:0x657200b4
y.create.l HWIO_RXFE_WB_IQMC_CFG0_WB2_ADDR A:0x657200b8
y.create.l HWIO_RXFE_WB_IQMC_CFG1_WB2_ADDR A:0x657200bc
y.create.l HWIO_RXFE_WB_IQMC_CURR_VALS_WB2_ADDR A:0x657200c0
y.create.l HWIO_RXFE_WB_IQMC_UPDT_CMD_WB2_ADDR A:0x657200c4
y.create.l HWIO_RXFE_WB_IQMC_UPDT_ACTION_SAMPLE_WB2_ADDR A:0x657200c8
y.create.l HWIO_RXFE_WB_NOTCH_FILT0_CFG0_WB2_ADDR A:0x657200cc
y.create.l HWIO_RXFE_WB_NOTCH_FILT1_CFG0_WB2_ADDR A:0x657200d0
y.create.l HWIO_RXFE_WB_NOTCH_FILT2_CFG0_WB2_ADDR A:0x657200d4
y.create.l HWIO_RXFE_WB_NOTCH_FILT3_CFG0_WB2_ADDR A:0x657200d8
y.create.l HWIO_RXFE_WB_NOTCH_FILT0_CFG1_WB2_ADDR A:0x657200dc
y.create.l HWIO_RXFE_WB_NOTCH_FILT1_CFG1_WB2_ADDR A:0x657200e0
y.create.l HWIO_RXFE_WB_NOTCH_FILT2_CFG1_WB2_ADDR A:0x657200e4
y.create.l HWIO_RXFE_WB_NOTCH_FILT3_CFG1_WB2_ADDR A:0x657200e8
y.create.l HWIO_RXFE_WB_NOTCH_FILT01_CFG_WB2_ADDR A:0x657200f0
y.create.l HWIO_RXFE_WB_NOTCH_FILT23_CFG_WB2_ADDR A:0x657200f4
y.create.l HWIO_RXFE_WB_SPARE_REG_WB2_ADDR A:0x657200f8
y.create.l HWIO_RXFE_WB_TOP_CTL_WB3_ADDR A:0x65728000
y.create.l HWIO_RXFE_WB_TOP_CMD_WB3_ADDR A:0x65728004
y.create.l HWIO_RXFE_WB_TOP_STATUS_WB3_ADDR A:0x65728008
y.create.l HWIO_RXFE_WB_STOPGATE_ACTION_SAMPLE_WB3_ADDR A:0x6572800c
y.create.l HWIO_RXFE_WB_TIMINGCTL_STATUS_WB3_ADDR A:0x65728010
y.create.l HWIO_RXFE_WB_MISC_CFG_WB3_ADDR A:0x65728014
y.create.l HWIO_RXFE_WB_WBPWR_CFG_WB3_ADDR A:0x65728018
y.create.l HWIO_RXFE_WB_WBPWR_CMD_WB3_ADDR A:0x6572801c
y.create.l HWIO_RXFE_WB_WBPWR_START_ACTION_SAMPLE_WB3_ADDR A:0x65728020
y.create.l HWIO_RXFE_WB_WBPWR_START_MASK_WB3_ADDR A:0x65728024
y.create.l HWIO_RXFE_WB_WBPWR_STOP_ACTION_SAMPLE_WB3_ADDR A:0x65728028
y.create.l HWIO_RXFE_WB_WBPWR_FINAL_ACC_WB3_ADDR A:0x6572802c
y.create.l HWIO_RXFE_WB_WBPWR_CURR_ACC_WB3_ADDR A:0x65728030
y.create.l HWIO_RXFE_WB_WBPWR_MAX_ACC_WB3_ADDR A:0x65728034
y.create.l HWIO_RXFE_WB_WBDC_CFG_WB3_ADDR A:0x65728038
y.create.l HWIO_RXFE_WB_WBDC_CMD_WB3_ADDR A:0x6572803c
y.create.l HWIO_RXFE_WB_WBDC_START_ACTION_SAMPLE_WB3_ADDR A:0x65728040
y.create.l HWIO_RXFE_WB_WBDC_STOP_ACTION_SAMPLE_WB3_ADDR A:0x65728044
y.create.l HWIO_RXFE_WB_WBDC_UPDATE_ACTION_SAMPLE_WB3_ADDR A:0x65728048
y.create.l HWIO_RXFE_WB_WBDC_UPDATE_DELAY_WB3_ADDR A:0x6572804c
y.create.l HWIO_RXFE_WB_WBDC_OVRD_I_WB3_ADDR A:0x65728050
y.create.l HWIO_RXFE_WB_WBDC_OVRD_Q_WB3_ADDR A:0x65728054
y.create.l HWIO_RXFE_WB_WBDC_EST1_CURR_I_WB3_ADDR A:0x65728058
y.create.l HWIO_RXFE_WB_WBDC_EST1_CURR_Q_WB3_ADDR A:0x6572805c
y.create.l HWIO_RXFE_WB_WBDC_EST1_PREV_I_WB3_ADDR A:0x65728060
y.create.l HWIO_RXFE_WB_WBDC_EST1_PREV_Q_WB3_ADDR A:0x65728064
y.create.l HWIO_RXFE_WB_WBDC_EST1_LOAD_I_WB3_ADDR A:0x65728068
y.create.l HWIO_RXFE_WB_WBDC_EST1_LOAD_Q_WB3_ADDR A:0x6572806c
y.create.l HWIO_RXFE_WB_WBDC_EST2_CURR_I_WB3_ADDR A:0x65728070
y.create.l HWIO_RXFE_WB_WBDC_EST2_CURR_Q_WB3_ADDR A:0x65728074
y.create.l HWIO_RXFE_WB_WBDC_EST2_PREV_I_WB3_ADDR A:0x65728078
y.create.l HWIO_RXFE_WB_WBDC_EST2_PREV_Q_WB3_ADDR A:0x6572807c
y.create.l HWIO_RXFE_WB_WBDC_EST2_LOAD_I_WB3_ADDR A:0x65728080
y.create.l HWIO_RXFE_WB_WBDC_EST2_LOAD_Q_WB3_ADDR A:0x65728084
y.create.l HWIO_RXFE_WB_VSRC_CFG_WB3_ADDR A:0x65728088
y.create.l HWIO_RXFE_WB_VSRC_T2BYT1M1_WB3_ADDR A:0x6572808c
y.create.l HWIO_RXFE_WB_VSRC_CMD_WB3_ADDR A:0x65728090
y.create.l HWIO_RXFE_WB_VSRC_STATUS_WB3_ADDR A:0x65728094
y.create.l HWIO_RXFE_WB_VSRC_UPDT_ACTION_SAMPLE_WB3_ADDR A:0x65728098
y.create.l HWIO_RXFE_WB_VSRC_CURR_T1BYT2_WB3_ADDR A:0x6572809c
y.create.l HWIO_RXFE_WB_VSRC_CURR_T2BYT1M1_WB3_ADDR A:0x657280a0
y.create.l HWIO_RXFE_WB_VSRC_SCTR_LOAD_VALUE_WB3_ADDR A:0x657280a4
y.create.l HWIO_RXFE_WB_VSRC_SCTR_WA_WB3_ADDR A:0x657280a8
y.create.l HWIO_RXFE_WB_VSRC_SCTR_SNAPSHOT_WB3_ADDR A:0x657280ac
y.create.l HWIO_RXFE_WB_VSRC_ACC_SNAPSHOT_WB3_ADDR A:0x657280b0
y.create.l HWIO_RXFE_WB_DEC_FILT_CFG_WB3_ADDR A:0x657280b4
y.create.l HWIO_RXFE_WB_IQMC_CFG0_WB3_ADDR A:0x657280b8
y.create.l HWIO_RXFE_WB_IQMC_CFG1_WB3_ADDR A:0x657280bc
y.create.l HWIO_RXFE_WB_IQMC_CURR_VALS_WB3_ADDR A:0x657280c0
y.create.l HWIO_RXFE_WB_IQMC_UPDT_CMD_WB3_ADDR A:0x657280c4
y.create.l HWIO_RXFE_WB_IQMC_UPDT_ACTION_SAMPLE_WB3_ADDR A:0x657280c8
y.create.l HWIO_RXFE_WB_NOTCH_FILT0_CFG0_WB3_ADDR A:0x657280cc
y.create.l HWIO_RXFE_WB_NOTCH_FILT1_CFG0_WB3_ADDR A:0x657280d0
y.create.l HWIO_RXFE_WB_NOTCH_FILT2_CFG0_WB3_ADDR A:0x657280d4
y.create.l HWIO_RXFE_WB_NOTCH_FILT3_CFG0_WB3_ADDR A:0x657280d8
y.create.l HWIO_RXFE_WB_NOTCH_FILT0_CFG1_WB3_ADDR A:0x657280dc
y.create.l HWIO_RXFE_WB_NOTCH_FILT1_CFG1_WB3_ADDR A:0x657280e0
y.create.l HWIO_RXFE_WB_NOTCH_FILT2_CFG1_WB3_ADDR A:0x657280e4
y.create.l HWIO_RXFE_WB_NOTCH_FILT3_CFG1_WB3_ADDR A:0x657280e8
y.create.l HWIO_RXFE_WB_NOTCH_FILT01_CFG_WB3_ADDR A:0x657280f0
y.create.l HWIO_RXFE_WB_NOTCH_FILT23_CFG_WB3_ADDR A:0x657280f4
y.create.l HWIO_RXFE_WB_SPARE_REG_WB3_ADDR A:0x657280f8
y.create.l HWIO_RXFE_WB_TOP_CTL_WB4_ADDR A:0x65730000
y.create.l HWIO_RXFE_WB_TOP_CMD_WB4_ADDR A:0x65730004
y.create.l HWIO_RXFE_WB_TOP_STATUS_WB4_ADDR A:0x65730008
y.create.l HWIO_RXFE_WB_STOPGATE_ACTION_SAMPLE_WB4_ADDR A:0x6573000c
y.create.l HWIO_RXFE_WB_TIMINGCTL_STATUS_WB4_ADDR A:0x65730010
y.create.l HWIO_RXFE_WB_MISC_CFG_WB4_ADDR A:0x65730014
y.create.l HWIO_RXFE_WB_WBPWR_CFG_WB4_ADDR A:0x65730018
y.create.l HWIO_RXFE_WB_WBPWR_CMD_WB4_ADDR A:0x6573001c
y.create.l HWIO_RXFE_WB_WBPWR_START_ACTION_SAMPLE_WB4_ADDR A:0x65730020
y.create.l HWIO_RXFE_WB_WBPWR_START_MASK_WB4_ADDR A:0x65730024
y.create.l HWIO_RXFE_WB_WBPWR_STOP_ACTION_SAMPLE_WB4_ADDR A:0x65730028
y.create.l HWIO_RXFE_WB_WBPWR_FINAL_ACC_WB4_ADDR A:0x6573002c
y.create.l HWIO_RXFE_WB_WBPWR_CURR_ACC_WB4_ADDR A:0x65730030
y.create.l HWIO_RXFE_WB_WBPWR_MAX_ACC_WB4_ADDR A:0x65730034
y.create.l HWIO_RXFE_WB_WBDC_CFG_WB4_ADDR A:0x65730038
y.create.l HWIO_RXFE_WB_WBDC_CMD_WB4_ADDR A:0x6573003c
y.create.l HWIO_RXFE_WB_WBDC_START_ACTION_SAMPLE_WB4_ADDR A:0x65730040
y.create.l HWIO_RXFE_WB_WBDC_STOP_ACTION_SAMPLE_WB4_ADDR A:0x65730044
y.create.l HWIO_RXFE_WB_WBDC_UPDATE_ACTION_SAMPLE_WB4_ADDR A:0x65730048
y.create.l HWIO_RXFE_WB_WBDC_UPDATE_DELAY_WB4_ADDR A:0x6573004c
y.create.l HWIO_RXFE_WB_WBDC_OVRD_I_WB4_ADDR A:0x65730050
y.create.l HWIO_RXFE_WB_WBDC_OVRD_Q_WB4_ADDR A:0x65730054
y.create.l HWIO_RXFE_WB_WBDC_EST1_CURR_I_WB4_ADDR A:0x65730058
y.create.l HWIO_RXFE_WB_WBDC_EST1_CURR_Q_WB4_ADDR A:0x6573005c
y.create.l HWIO_RXFE_WB_WBDC_EST1_PREV_I_WB4_ADDR A:0x65730060
y.create.l HWIO_RXFE_WB_WBDC_EST1_PREV_Q_WB4_ADDR A:0x65730064
y.create.l HWIO_RXFE_WB_WBDC_EST1_LOAD_I_WB4_ADDR A:0x65730068
y.create.l HWIO_RXFE_WB_WBDC_EST1_LOAD_Q_WB4_ADDR A:0x6573006c
y.create.l HWIO_RXFE_WB_WBDC_EST2_CURR_I_WB4_ADDR A:0x65730070
y.create.l HWIO_RXFE_WB_WBDC_EST2_CURR_Q_WB4_ADDR A:0x65730074
y.create.l HWIO_RXFE_WB_WBDC_EST2_PREV_I_WB4_ADDR A:0x65730078
y.create.l HWIO_RXFE_WB_WBDC_EST2_PREV_Q_WB4_ADDR A:0x6573007c
y.create.l HWIO_RXFE_WB_WBDC_EST2_LOAD_I_WB4_ADDR A:0x65730080
y.create.l HWIO_RXFE_WB_WBDC_EST2_LOAD_Q_WB4_ADDR A:0x65730084
y.create.l HWIO_RXFE_WB_VSRC_CFG_WB4_ADDR A:0x65730088
y.create.l HWIO_RXFE_WB_VSRC_T2BYT1M1_WB4_ADDR A:0x6573008c
y.create.l HWIO_RXFE_WB_VSRC_CMD_WB4_ADDR A:0x65730090
y.create.l HWIO_RXFE_WB_VSRC_STATUS_WB4_ADDR A:0x65730094
y.create.l HWIO_RXFE_WB_VSRC_UPDT_ACTION_SAMPLE_WB4_ADDR A:0x65730098
y.create.l HWIO_RXFE_WB_VSRC_CURR_T1BYT2_WB4_ADDR A:0x6573009c
y.create.l HWIO_RXFE_WB_VSRC_CURR_T2BYT1M1_WB4_ADDR A:0x657300a0
y.create.l HWIO_RXFE_WB_VSRC_SCTR_LOAD_VALUE_WB4_ADDR A:0x657300a4
y.create.l HWIO_RXFE_WB_VSRC_SCTR_WA_WB4_ADDR A:0x657300a8
y.create.l HWIO_RXFE_WB_VSRC_SCTR_SNAPSHOT_WB4_ADDR A:0x657300ac
y.create.l HWIO_RXFE_WB_VSRC_ACC_SNAPSHOT_WB4_ADDR A:0x657300b0
y.create.l HWIO_RXFE_WB_DEC_FILT_CFG_WB4_ADDR A:0x657300b4
y.create.l HWIO_RXFE_WB_IQMC_CFG0_WB4_ADDR A:0x657300b8
y.create.l HWIO_RXFE_WB_IQMC_CFG1_WB4_ADDR A:0x657300bc
y.create.l HWIO_RXFE_WB_IQMC_CURR_VALS_WB4_ADDR A:0x657300c0
y.create.l HWIO_RXFE_WB_IQMC_UPDT_CMD_WB4_ADDR A:0x657300c4
y.create.l HWIO_RXFE_WB_IQMC_UPDT_ACTION_SAMPLE_WB4_ADDR A:0x657300c8
y.create.l HWIO_RXFE_WB_NOTCH_FILT0_CFG0_WB4_ADDR A:0x657300cc
y.create.l HWIO_RXFE_WB_NOTCH_FILT1_CFG0_WB4_ADDR A:0x657300d0
y.create.l HWIO_RXFE_WB_NOTCH_FILT2_CFG0_WB4_ADDR A:0x657300d4
y.create.l HWIO_RXFE_WB_NOTCH_FILT3_CFG0_WB4_ADDR A:0x657300d8
y.create.l HWIO_RXFE_WB_NOTCH_FILT0_CFG1_WB4_ADDR A:0x657300dc
y.create.l HWIO_RXFE_WB_NOTCH_FILT1_CFG1_WB4_ADDR A:0x657300e0
y.create.l HWIO_RXFE_WB_NOTCH_FILT2_CFG1_WB4_ADDR A:0x657300e4
y.create.l HWIO_RXFE_WB_NOTCH_FILT3_CFG1_WB4_ADDR A:0x657300e8
y.create.l HWIO_RXFE_WB_NOTCH_FILT01_CFG_WB4_ADDR A:0x657300f0
y.create.l HWIO_RXFE_WB_NOTCH_FILT23_CFG_WB4_ADDR A:0x657300f4
y.create.l HWIO_RXFE_WB_SPARE_REG_WB4_ADDR A:0x657300f8
y.create.l HWIO_RXFE_WB_TOP_CTL_WB5_ADDR A:0x65738000
y.create.l HWIO_RXFE_WB_TOP_CMD_WB5_ADDR A:0x65738004
y.create.l HWIO_RXFE_WB_TOP_STATUS_WB5_ADDR A:0x65738008
y.create.l HWIO_RXFE_WB_STOPGATE_ACTION_SAMPLE_WB5_ADDR A:0x6573800c
y.create.l HWIO_RXFE_WB_TIMINGCTL_STATUS_WB5_ADDR A:0x65738010
y.create.l HWIO_RXFE_WB_MISC_CFG_WB5_ADDR A:0x65738014
y.create.l HWIO_RXFE_WB_WBPWR_CFG_WB5_ADDR A:0x65738018
y.create.l HWIO_RXFE_WB_WBPWR_CMD_WB5_ADDR A:0x6573801c
y.create.l HWIO_RXFE_WB_WBPWR_START_ACTION_SAMPLE_WB5_ADDR A:0x65738020
y.create.l HWIO_RXFE_WB_WBPWR_START_MASK_WB5_ADDR A:0x65738024
y.create.l HWIO_RXFE_WB_WBPWR_STOP_ACTION_SAMPLE_WB5_ADDR A:0x65738028
y.create.l HWIO_RXFE_WB_WBPWR_FINAL_ACC_WB5_ADDR A:0x6573802c
y.create.l HWIO_RXFE_WB_WBPWR_CURR_ACC_WB5_ADDR A:0x65738030
y.create.l HWIO_RXFE_WB_WBPWR_MAX_ACC_WB5_ADDR A:0x65738034
y.create.l HWIO_RXFE_WB_WBDC_CFG_WB5_ADDR A:0x65738038
y.create.l HWIO_RXFE_WB_WBDC_CMD_WB5_ADDR A:0x6573803c
y.create.l HWIO_RXFE_WB_WBDC_START_ACTION_SAMPLE_WB5_ADDR A:0x65738040
y.create.l HWIO_RXFE_WB_WBDC_STOP_ACTION_SAMPLE_WB5_ADDR A:0x65738044
y.create.l HWIO_RXFE_WB_WBDC_UPDATE_ACTION_SAMPLE_WB5_ADDR A:0x65738048
y.create.l HWIO_RXFE_WB_WBDC_UPDATE_DELAY_WB5_ADDR A:0x6573804c
y.create.l HWIO_RXFE_WB_WBDC_OVRD_I_WB5_ADDR A:0x65738050
y.create.l HWIO_RXFE_WB_WBDC_OVRD_Q_WB5_ADDR A:0x65738054
y.create.l HWIO_RXFE_WB_WBDC_EST1_CURR_I_WB5_ADDR A:0x65738058
y.create.l HWIO_RXFE_WB_WBDC_EST1_CURR_Q_WB5_ADDR A:0x6573805c
y.create.l HWIO_RXFE_WB_WBDC_EST1_PREV_I_WB5_ADDR A:0x65738060
y.create.l HWIO_RXFE_WB_WBDC_EST1_PREV_Q_WB5_ADDR A:0x65738064
y.create.l HWIO_RXFE_WB_WBDC_EST1_LOAD_I_WB5_ADDR A:0x65738068
y.create.l HWIO_RXFE_WB_WBDC_EST1_LOAD_Q_WB5_ADDR A:0x6573806c
y.create.l HWIO_RXFE_WB_WBDC_EST2_CURR_I_WB5_ADDR A:0x65738070
y.create.l HWIO_RXFE_WB_WBDC_EST2_CURR_Q_WB5_ADDR A:0x65738074
y.create.l HWIO_RXFE_WB_WBDC_EST2_PREV_I_WB5_ADDR A:0x65738078
y.create.l HWIO_RXFE_WB_WBDC_EST2_PREV_Q_WB5_ADDR A:0x6573807c
y.create.l HWIO_RXFE_WB_WBDC_EST2_LOAD_I_WB5_ADDR A:0x65738080
y.create.l HWIO_RXFE_WB_WBDC_EST2_LOAD_Q_WB5_ADDR A:0x65738084
y.create.l HWIO_RXFE_WB_VSRC_CFG_WB5_ADDR A:0x65738088
y.create.l HWIO_RXFE_WB_VSRC_T2BYT1M1_WB5_ADDR A:0x6573808c
y.create.l HWIO_RXFE_WB_VSRC_CMD_WB5_ADDR A:0x65738090
y.create.l HWIO_RXFE_WB_VSRC_STATUS_WB5_ADDR A:0x65738094
y.create.l HWIO_RXFE_WB_VSRC_UPDT_ACTION_SAMPLE_WB5_ADDR A:0x65738098
y.create.l HWIO_RXFE_WB_VSRC_CURR_T1BYT2_WB5_ADDR A:0x6573809c
y.create.l HWIO_RXFE_WB_VSRC_CURR_T2BYT1M1_WB5_ADDR A:0x657380a0
y.create.l HWIO_RXFE_WB_VSRC_SCTR_LOAD_VALUE_WB5_ADDR A:0x657380a4
y.create.l HWIO_RXFE_WB_VSRC_SCTR_WA_WB5_ADDR A:0x657380a8
y.create.l HWIO_RXFE_WB_VSRC_SCTR_SNAPSHOT_WB5_ADDR A:0x657380ac
y.create.l HWIO_RXFE_WB_VSRC_ACC_SNAPSHOT_WB5_ADDR A:0x657380b0
y.create.l HWIO_RXFE_WB_DEC_FILT_CFG_WB5_ADDR A:0x657380b4
y.create.l HWIO_RXFE_WB_IQMC_CFG0_WB5_ADDR A:0x657380b8
y.create.l HWIO_RXFE_WB_IQMC_CFG1_WB5_ADDR A:0x657380bc
y.create.l HWIO_RXFE_WB_IQMC_CURR_VALS_WB5_ADDR A:0x657380c0
y.create.l HWIO_RXFE_WB_IQMC_UPDT_CMD_WB5_ADDR A:0x657380c4
y.create.l HWIO_RXFE_WB_IQMC_UPDT_ACTION_SAMPLE_WB5_ADDR A:0x657380c8
y.create.l HWIO_RXFE_WB_NOTCH_FILT0_CFG0_WB5_ADDR A:0x657380cc
y.create.l HWIO_RXFE_WB_NOTCH_FILT1_CFG0_WB5_ADDR A:0x657380d0
y.create.l HWIO_RXFE_WB_NOTCH_FILT2_CFG0_WB5_ADDR A:0x657380d4
y.create.l HWIO_RXFE_WB_NOTCH_FILT3_CFG0_WB5_ADDR A:0x657380d8
y.create.l HWIO_RXFE_WB_NOTCH_FILT0_CFG1_WB5_ADDR A:0x657380dc
y.create.l HWIO_RXFE_WB_NOTCH_FILT1_CFG1_WB5_ADDR A:0x657380e0
y.create.l HWIO_RXFE_WB_NOTCH_FILT2_CFG1_WB5_ADDR A:0x657380e4
y.create.l HWIO_RXFE_WB_NOTCH_FILT3_CFG1_WB5_ADDR A:0x657380e8
y.create.l HWIO_RXFE_WB_NOTCH_FILT01_CFG_WB5_ADDR A:0x657380f0
y.create.l HWIO_RXFE_WB_NOTCH_FILT23_CFG_WB5_ADDR A:0x657380f4
y.create.l HWIO_RXFE_WB_SPARE_REG_WB5_ADDR A:0x657380f8
y.create.l HWIO_RXFE_WB_TOP_CTL_WB6_ADDR A:0x65740000
y.create.l HWIO_RXFE_WB_TOP_CMD_WB6_ADDR A:0x65740004
y.create.l HWIO_RXFE_WB_TOP_STATUS_WB6_ADDR A:0x65740008
y.create.l HWIO_RXFE_WB_STOPGATE_ACTION_SAMPLE_WB6_ADDR A:0x6574000c
y.create.l HWIO_RXFE_WB_TIMINGCTL_STATUS_WB6_ADDR A:0x65740010
y.create.l HWIO_RXFE_WB_MISC_CFG_WB6_ADDR A:0x65740014
y.create.l HWIO_RXFE_WB_WBPWR_CFG_WB6_ADDR A:0x65740018
y.create.l HWIO_RXFE_WB_WBPWR_CMD_WB6_ADDR A:0x6574001c
y.create.l HWIO_RXFE_WB_WBPWR_START_ACTION_SAMPLE_WB6_ADDR A:0x65740020
y.create.l HWIO_RXFE_WB_WBPWR_START_MASK_WB6_ADDR A:0x65740024
y.create.l HWIO_RXFE_WB_WBPWR_STOP_ACTION_SAMPLE_WB6_ADDR A:0x65740028
y.create.l HWIO_RXFE_WB_WBPWR_FINAL_ACC_WB6_ADDR A:0x6574002c
y.create.l HWIO_RXFE_WB_WBPWR_CURR_ACC_WB6_ADDR A:0x65740030
y.create.l HWIO_RXFE_WB_WBPWR_MAX_ACC_WB6_ADDR A:0x65740034
y.create.l HWIO_RXFE_WB_WBDC_CFG_WB6_ADDR A:0x65740038
y.create.l HWIO_RXFE_WB_WBDC_CMD_WB6_ADDR A:0x6574003c
y.create.l HWIO_RXFE_WB_WBDC_START_ACTION_SAMPLE_WB6_ADDR A:0x65740040
y.create.l HWIO_RXFE_WB_WBDC_STOP_ACTION_SAMPLE_WB6_ADDR A:0x65740044
y.create.l HWIO_RXFE_WB_WBDC_UPDATE_ACTION_SAMPLE_WB6_ADDR A:0x65740048
y.create.l HWIO_RXFE_WB_WBDC_UPDATE_DELAY_WB6_ADDR A:0x6574004c
y.create.l HWIO_RXFE_WB_WBDC_OVRD_I_WB6_ADDR A:0x65740050
y.create.l HWIO_RXFE_WB_WBDC_OVRD_Q_WB6_ADDR A:0x65740054
y.create.l HWIO_RXFE_WB_WBDC_EST1_CURR_I_WB6_ADDR A:0x65740058
y.create.l HWIO_RXFE_WB_WBDC_EST1_CURR_Q_WB6_ADDR A:0x6574005c
y.create.l HWIO_RXFE_WB_WBDC_EST1_PREV_I_WB6_ADDR A:0x65740060
y.create.l HWIO_RXFE_WB_WBDC_EST1_PREV_Q_WB6_ADDR A:0x65740064
y.create.l HWIO_RXFE_WB_WBDC_EST1_LOAD_I_WB6_ADDR A:0x65740068
y.create.l HWIO_RXFE_WB_WBDC_EST1_LOAD_Q_WB6_ADDR A:0x6574006c
y.create.l HWIO_RXFE_WB_WBDC_EST2_CURR_I_WB6_ADDR A:0x65740070
y.create.l HWIO_RXFE_WB_WBDC_EST2_CURR_Q_WB6_ADDR A:0x65740074
y.create.l HWIO_RXFE_WB_WBDC_EST2_PREV_I_WB6_ADDR A:0x65740078
y.create.l HWIO_RXFE_WB_WBDC_EST2_PREV_Q_WB6_ADDR A:0x6574007c
y.create.l HWIO_RXFE_WB_WBDC_EST2_LOAD_I_WB6_ADDR A:0x65740080
y.create.l HWIO_RXFE_WB_WBDC_EST2_LOAD_Q_WB6_ADDR A:0x65740084
y.create.l HWIO_RXFE_WB_VSRC_CFG_WB6_ADDR A:0x65740088
y.create.l HWIO_RXFE_WB_VSRC_T2BYT1M1_WB6_ADDR A:0x6574008c
y.create.l HWIO_RXFE_WB_VSRC_CMD_WB6_ADDR A:0x65740090
y.create.l HWIO_RXFE_WB_VSRC_STATUS_WB6_ADDR A:0x65740094
y.create.l HWIO_RXFE_WB_VSRC_UPDT_ACTION_SAMPLE_WB6_ADDR A:0x65740098
y.create.l HWIO_RXFE_WB_VSRC_CURR_T1BYT2_WB6_ADDR A:0x6574009c
y.create.l HWIO_RXFE_WB_VSRC_CURR_T2BYT1M1_WB6_ADDR A:0x657400a0
y.create.l HWIO_RXFE_WB_VSRC_SCTR_LOAD_VALUE_WB6_ADDR A:0x657400a4
y.create.l HWIO_RXFE_WB_VSRC_SCTR_WA_WB6_ADDR A:0x657400a8
y.create.l HWIO_RXFE_WB_VSRC_SCTR_SNAPSHOT_WB6_ADDR A:0x657400ac
y.create.l HWIO_RXFE_WB_VSRC_ACC_SNAPSHOT_WB6_ADDR A:0x657400b0
y.create.l HWIO_RXFE_WB_DEC_FILT_CFG_WB6_ADDR A:0x657400b4
y.create.l HWIO_RXFE_WB_IQMC_CFG0_WB6_ADDR A:0x657400b8
y.create.l HWIO_RXFE_WB_IQMC_CFG1_WB6_ADDR A:0x657400bc
y.create.l HWIO_RXFE_WB_IQMC_CURR_VALS_WB6_ADDR A:0x657400c0
y.create.l HWIO_RXFE_WB_IQMC_UPDT_CMD_WB6_ADDR A:0x657400c4
y.create.l HWIO_RXFE_WB_IQMC_UPDT_ACTION_SAMPLE_WB6_ADDR A:0x657400c8
y.create.l HWIO_RXFE_WB_NOTCH_FILT0_CFG0_WB6_ADDR A:0x657400cc
y.create.l HWIO_RXFE_WB_NOTCH_FILT1_CFG0_WB6_ADDR A:0x657400d0
y.create.l HWIO_RXFE_WB_NOTCH_FILT2_CFG0_WB6_ADDR A:0x657400d4
y.create.l HWIO_RXFE_WB_NOTCH_FILT3_CFG0_WB6_ADDR A:0x657400d8
y.create.l HWIO_RXFE_WB_NOTCH_FILT0_CFG1_WB6_ADDR A:0x657400dc
y.create.l HWIO_RXFE_WB_NOTCH_FILT1_CFG1_WB6_ADDR A:0x657400e0
y.create.l HWIO_RXFE_WB_NOTCH_FILT2_CFG1_WB6_ADDR A:0x657400e4
y.create.l HWIO_RXFE_WB_NOTCH_FILT3_CFG1_WB6_ADDR A:0x657400e8
y.create.l HWIO_RXFE_WB_NOTCH_FILT01_CFG_WB6_ADDR A:0x657400f0
y.create.l HWIO_RXFE_WB_NOTCH_FILT23_CFG_WB6_ADDR A:0x657400f4
y.create.l HWIO_RXFE_WB_SPARE_REG_WB6_ADDR A:0x657400f8
y.create.l HWIO_RXFE_NB_TOP_CTL_NB0_ADDR A:0x65748000
y.create.l HWIO_RXFE_NB_GATE_CMD_NB0_ADDR A:0x65748004
y.create.l HWIO_RXFE_NB_GATE_STATUS_NB0_ADDR A:0x65748008
y.create.l HWIO_RXFE_NB_GATE_ACTION_SAMPLE_NB0_ADDR A:0x6574800c
y.create.l HWIO_RXFE_NB_TIMINGCTL_STATUS_NB0_ADDR A:0x65748010
y.create.l HWIO_RXFE_NB_CSR_CFG_NB0_ADDR A:0x65748014
y.create.l HWIO_RXFE_NB_CSR_CMD_NB0_ADDR A:0x65748018
y.create.l HWIO_RXFE_NB_CSR_PHASEUPDT_ACTION_SAMPLE_NB0_ADDR A:0x6574801c
y.create.l HWIO_RXFE_NB_CSR_FREQUPDT_ACTION_SAMPLE_NB0_ADDR A:0x65748020
y.create.l HWIO_RXFE_NB_CSR_PHASE_OFFSET_NB0_ADDR A:0x65748024
y.create.l HWIO_RXFE_NB_CSR_FREQ_OFFSET_NB0_ADDR A:0x65748028
y.create.l HWIO_RXFE_NB_CSR_CURR_PHASE_OFFSET_NB0_ADDR A:0x6574802c
y.create.l HWIO_RXFE_NB_CSR_CURR_FREQ_OFFSET_NB0_ADDR A:0x65748030
y.create.l HWIO_RXFE_NB_FILTERS_CFG_NB0_ADDR A:0x65748034
y.create.l HWIO_RXFE_NB_ICI_COEF0_NB0_ADDR A:0x6574803c
y.create.l HWIO_RXFE_NB_ICI_COEF1_NB0_ADDR A:0x65748040
y.create.l HWIO_RXFE_NB_ICI_COEF2_NB0_ADDR A:0x65748044
y.create.l HWIO_RXFE_NB_ICI_COEF3_NB0_ADDR A:0x65748048
y.create.l HWIO_RXFE_NB_ICI_COEF4_NB0_ADDR A:0x6574804c
y.create.l HWIO_RXFE_NB_ICI_COEF5_NB0_ADDR A:0x65748050
y.create.l HWIO_RXFE_NB_ICI_COEF6_NB0_ADDR A:0x65748054
y.create.l HWIO_RXFE_NB_ICI_COEF7_NB0_ADDR A:0x65748058
y.create.l HWIO_RXFE_NB_ICI_COEF8_NB0_ADDR A:0x6574805c
y.create.l HWIO_RXFE_NB_ICI_COEF9_NB0_ADDR A:0x65748060
y.create.l HWIO_RXFE_NB_GDA_NB0_ADDR A:0x65748068
y.create.l HWIO_RXFE_NB_NBDC_COMPVAL_I_NB0_ADDR A:0x6574806c
y.create.l HWIO_RXFE_NB_NBDC_COMPVAL_Q_NB0_ADDR A:0x65748070
y.create.l HWIO_RXFE_NB_NBPWR_CFG_NB0_ADDR A:0x65748074
y.create.l HWIO_RXFE_NB_NBPWR_CMD_NB0_ADDR A:0x65748078
y.create.l HWIO_RXFE_NB_NBPWR_START_ACTION_SAMPLE_NB0_ADDR A:0x6574807c
y.create.l HWIO_RXFE_NB_NBPWR_START_MASK_NB0_ADDR A:0x65748080
y.create.l HWIO_RXFE_NB_NBPWR_STOP_ACTION_SAMPLE_NB0_ADDR A:0x65748084
y.create.l HWIO_RXFE_NB_NBPWR_FINAL_ACC_NB0_ADDR A:0x65748088
y.create.l HWIO_RXFE_NB_NBPWR_CURR_ACC_NB0_ADDR A:0x6574808c
y.create.l HWIO_RXFE_NB_NBPWR_MAX_ACC_NB0_ADDR A:0x65748090
y.create.l HWIO_RXFE_NB_DVGA_CFG_NB0_ADDR A:0x65748094
y.create.l HWIO_RXFE_NB_DVGA_RXFE_GAIN_NB0_ADDR A:0x65748098
y.create.l HWIO_RXFE_NB_DVGA_OVERRIDE_DVGA_GAIN_NB0_ADDR A:0x6574809c
y.create.l HWIO_RXFE_NB_DVGA_CMD_NB0_ADDR A:0x657480a0
y.create.l HWIO_RXFE_NB_DVGA_UPDT_ACTION_SAMPLE_NB0_ADDR A:0x657480a4
y.create.l HWIO_RXFE_NB_DVGA_UPDT_MASK_NB0_ADDR A:0x657480a8
y.create.l HWIO_RXFE_NB_FINAL_BITWIDTHS_CFG_NB0_ADDR A:0x657480ac
y.create.l HWIO_RXFE_NB_WTR_CFG_NB0_ADDR A:0x657480b0
y.create.l HWIO_RXFE_NB_WTR_FUNC_CFG_NB0_ADDR A:0x657480b4
y.create.l HWIO_RXFE_NB_WTR_DBG_CFG0_NB0_ADDR A:0x657480b8
y.create.l HWIO_RXFE_NB_WTR_DBG_CFG1_NB0_ADDR A:0x657480bc
y.create.l HWIO_RXFE_NB_WTR_CMD_NB0_ADDR A:0x657480c0
y.create.l HWIO_RXFE_NB_WTR_START_ACTION_SAMPLE_NB0_ADDR A:0x657480c4
y.create.l HWIO_RXFE_NB_WTR_STOP_ACTION_SAMPLE_NB0_ADDR A:0x657480c8
y.create.l HWIO_RXFE_NB_WTR_STATUS_NB0_ADDR A:0x657480d0
y.create.l HWIO_RXFE_NB_WTR_ADDR_SNAPSHOT_NB0_ADDR A:0x657480d4
y.create.l HWIO_RXFE_NB_SPARE_REG_NB0_ADDR A:0x657480d8
y.create.l HWIO_RXFE_NB_TOP_CTL_NB1_ADDR A:0x65750000
y.create.l HWIO_RXFE_NB_GATE_CMD_NB1_ADDR A:0x65750004
y.create.l HWIO_RXFE_NB_GATE_STATUS_NB1_ADDR A:0x65750008
y.create.l HWIO_RXFE_NB_GATE_ACTION_SAMPLE_NB1_ADDR A:0x6575000c
y.create.l HWIO_RXFE_NB_TIMINGCTL_STATUS_NB1_ADDR A:0x65750010
y.create.l HWIO_RXFE_NB_CSR_CFG_NB1_ADDR A:0x65750014
y.create.l HWIO_RXFE_NB_CSR_CMD_NB1_ADDR A:0x65750018
y.create.l HWIO_RXFE_NB_CSR_PHASEUPDT_ACTION_SAMPLE_NB1_ADDR A:0x6575001c
y.create.l HWIO_RXFE_NB_CSR_FREQUPDT_ACTION_SAMPLE_NB1_ADDR A:0x65750020
y.create.l HWIO_RXFE_NB_CSR_PHASE_OFFSET_NB1_ADDR A:0x65750024
y.create.l HWIO_RXFE_NB_CSR_FREQ_OFFSET_NB1_ADDR A:0x65750028
y.create.l HWIO_RXFE_NB_CSR_CURR_PHASE_OFFSET_NB1_ADDR A:0x6575002c
y.create.l HWIO_RXFE_NB_CSR_CURR_FREQ_OFFSET_NB1_ADDR A:0x65750030
y.create.l HWIO_RXFE_NB_FILTERS_CFG_NB1_ADDR A:0x65750034
y.create.l HWIO_RXFE_NB_ICI_COEF0_NB1_ADDR A:0x6575003c
y.create.l HWIO_RXFE_NB_ICI_COEF1_NB1_ADDR A:0x65750040
y.create.l HWIO_RXFE_NB_ICI_COEF2_NB1_ADDR A:0x65750044
y.create.l HWIO_RXFE_NB_ICI_COEF3_NB1_ADDR A:0x65750048
y.create.l HWIO_RXFE_NB_ICI_COEF4_NB1_ADDR A:0x6575004c
y.create.l HWIO_RXFE_NB_ICI_COEF5_NB1_ADDR A:0x65750050
y.create.l HWIO_RXFE_NB_ICI_COEF6_NB1_ADDR A:0x65750054
y.create.l HWIO_RXFE_NB_ICI_COEF7_NB1_ADDR A:0x65750058
y.create.l HWIO_RXFE_NB_ICI_COEF8_NB1_ADDR A:0x6575005c
y.create.l HWIO_RXFE_NB_ICI_COEF9_NB1_ADDR A:0x65750060
y.create.l HWIO_RXFE_NB_GDA_NB1_ADDR A:0x65750068
y.create.l HWIO_RXFE_NB_NBDC_COMPVAL_I_NB1_ADDR A:0x6575006c
y.create.l HWIO_RXFE_NB_NBDC_COMPVAL_Q_NB1_ADDR A:0x65750070
y.create.l HWIO_RXFE_NB_NBPWR_CFG_NB1_ADDR A:0x65750074
y.create.l HWIO_RXFE_NB_NBPWR_CMD_NB1_ADDR A:0x65750078
y.create.l HWIO_RXFE_NB_NBPWR_START_ACTION_SAMPLE_NB1_ADDR A:0x6575007c
y.create.l HWIO_RXFE_NB_NBPWR_START_MASK_NB1_ADDR A:0x65750080
y.create.l HWIO_RXFE_NB_NBPWR_STOP_ACTION_SAMPLE_NB1_ADDR A:0x65750084
y.create.l HWIO_RXFE_NB_NBPWR_FINAL_ACC_NB1_ADDR A:0x65750088
y.create.l HWIO_RXFE_NB_NBPWR_CURR_ACC_NB1_ADDR A:0x6575008c
y.create.l HWIO_RXFE_NB_NBPWR_MAX_ACC_NB1_ADDR A:0x65750090
y.create.l HWIO_RXFE_NB_DVGA_CFG_NB1_ADDR A:0x65750094
y.create.l HWIO_RXFE_NB_DVGA_RXFE_GAIN_NB1_ADDR A:0x65750098
y.create.l HWIO_RXFE_NB_DVGA_OVERRIDE_DVGA_GAIN_NB1_ADDR A:0x6575009c
y.create.l HWIO_RXFE_NB_DVGA_CMD_NB1_ADDR A:0x657500a0
y.create.l HWIO_RXFE_NB_DVGA_UPDT_ACTION_SAMPLE_NB1_ADDR A:0x657500a4
y.create.l HWIO_RXFE_NB_DVGA_UPDT_MASK_NB1_ADDR A:0x657500a8
y.create.l HWIO_RXFE_NB_FINAL_BITWIDTHS_CFG_NB1_ADDR A:0x657500ac
y.create.l HWIO_RXFE_NB_WTR_CFG_NB1_ADDR A:0x657500b0
y.create.l HWIO_RXFE_NB_WTR_FUNC_CFG_NB1_ADDR A:0x657500b4
y.create.l HWIO_RXFE_NB_WTR_DBG_CFG0_NB1_ADDR A:0x657500b8
y.create.l HWIO_RXFE_NB_WTR_DBG_CFG1_NB1_ADDR A:0x657500bc
y.create.l HWIO_RXFE_NB_WTR_CMD_NB1_ADDR A:0x657500c0
y.create.l HWIO_RXFE_NB_WTR_START_ACTION_SAMPLE_NB1_ADDR A:0x657500c4
y.create.l HWIO_RXFE_NB_WTR_STOP_ACTION_SAMPLE_NB1_ADDR A:0x657500c8
y.create.l HWIO_RXFE_NB_WTR_STATUS_NB1_ADDR A:0x657500d0
y.create.l HWIO_RXFE_NB_WTR_ADDR_SNAPSHOT_NB1_ADDR A:0x657500d4
y.create.l HWIO_RXFE_NB_SPARE_REG_NB1_ADDR A:0x657500d8
y.create.l HWIO_RXFE_NB_TOP_CTL_NB2_ADDR A:0x65758000
y.create.l HWIO_RXFE_NB_GATE_CMD_NB2_ADDR A:0x65758004
y.create.l HWIO_RXFE_NB_GATE_STATUS_NB2_ADDR A:0x65758008
y.create.l HWIO_RXFE_NB_GATE_ACTION_SAMPLE_NB2_ADDR A:0x6575800c
y.create.l HWIO_RXFE_NB_TIMINGCTL_STATUS_NB2_ADDR A:0x65758010
y.create.l HWIO_RXFE_NB_CSR_CFG_NB2_ADDR A:0x65758014
y.create.l HWIO_RXFE_NB_CSR_CMD_NB2_ADDR A:0x65758018
y.create.l HWIO_RXFE_NB_CSR_PHASEUPDT_ACTION_SAMPLE_NB2_ADDR A:0x6575801c
y.create.l HWIO_RXFE_NB_CSR_FREQUPDT_ACTION_SAMPLE_NB2_ADDR A:0x65758020
y.create.l HWIO_RXFE_NB_CSR_PHASE_OFFSET_NB2_ADDR A:0x65758024
y.create.l HWIO_RXFE_NB_CSR_FREQ_OFFSET_NB2_ADDR A:0x65758028
y.create.l HWIO_RXFE_NB_CSR_CURR_PHASE_OFFSET_NB2_ADDR A:0x6575802c
y.create.l HWIO_RXFE_NB_CSR_CURR_FREQ_OFFSET_NB2_ADDR A:0x65758030
y.create.l HWIO_RXFE_NB_FILTERS_CFG_NB2_ADDR A:0x65758034
y.create.l HWIO_RXFE_NB_ICI_COEF0_NB2_ADDR A:0x6575803c
y.create.l HWIO_RXFE_NB_ICI_COEF1_NB2_ADDR A:0x65758040
y.create.l HWIO_RXFE_NB_ICI_COEF2_NB2_ADDR A:0x65758044
y.create.l HWIO_RXFE_NB_ICI_COEF3_NB2_ADDR A:0x65758048
y.create.l HWIO_RXFE_NB_ICI_COEF4_NB2_ADDR A:0x6575804c
y.create.l HWIO_RXFE_NB_ICI_COEF5_NB2_ADDR A:0x65758050
y.create.l HWIO_RXFE_NB_ICI_COEF6_NB2_ADDR A:0x65758054
y.create.l HWIO_RXFE_NB_ICI_COEF7_NB2_ADDR A:0x65758058
y.create.l HWIO_RXFE_NB_ICI_COEF8_NB2_ADDR A:0x6575805c
y.create.l HWIO_RXFE_NB_ICI_COEF9_NB2_ADDR A:0x65758060
y.create.l HWIO_RXFE_NB_GDA_NB2_ADDR A:0x65758068
y.create.l HWIO_RXFE_NB_NBDC_COMPVAL_I_NB2_ADDR A:0x6575806c
y.create.l HWIO_RXFE_NB_NBDC_COMPVAL_Q_NB2_ADDR A:0x65758070
y.create.l HWIO_RXFE_NB_NBPWR_CFG_NB2_ADDR A:0x65758074
y.create.l HWIO_RXFE_NB_NBPWR_CMD_NB2_ADDR A:0x65758078
y.create.l HWIO_RXFE_NB_NBPWR_START_ACTION_SAMPLE_NB2_ADDR A:0x6575807c
y.create.l HWIO_RXFE_NB_NBPWR_START_MASK_NB2_ADDR A:0x65758080
y.create.l HWIO_RXFE_NB_NBPWR_STOP_ACTION_SAMPLE_NB2_ADDR A:0x65758084
y.create.l HWIO_RXFE_NB_NBPWR_FINAL_ACC_NB2_ADDR A:0x65758088
y.create.l HWIO_RXFE_NB_NBPWR_CURR_ACC_NB2_ADDR A:0x6575808c
y.create.l HWIO_RXFE_NB_NBPWR_MAX_ACC_NB2_ADDR A:0x65758090
y.create.l HWIO_RXFE_NB_DVGA_CFG_NB2_ADDR A:0x65758094
y.create.l HWIO_RXFE_NB_DVGA_RXFE_GAIN_NB2_ADDR A:0x65758098
y.create.l HWIO_RXFE_NB_DVGA_OVERRIDE_DVGA_GAIN_NB2_ADDR A:0x6575809c
y.create.l HWIO_RXFE_NB_DVGA_CMD_NB2_ADDR A:0x657580a0
y.create.l HWIO_RXFE_NB_DVGA_UPDT_ACTION_SAMPLE_NB2_ADDR A:0x657580a4
y.create.l HWIO_RXFE_NB_DVGA_UPDT_MASK_NB2_ADDR A:0x657580a8
y.create.l HWIO_RXFE_NB_FINAL_BITWIDTHS_CFG_NB2_ADDR A:0x657580ac
y.create.l HWIO_RXFE_NB_WTR_CFG_NB2_ADDR A:0x657580b0
y.create.l HWIO_RXFE_NB_WTR_FUNC_CFG_NB2_ADDR A:0x657580b4
y.create.l HWIO_RXFE_NB_WTR_DBG_CFG0_NB2_ADDR A:0x657580b8
y.create.l HWIO_RXFE_NB_WTR_DBG_CFG1_NB2_ADDR A:0x657580bc
y.create.l HWIO_RXFE_NB_WTR_CMD_NB2_ADDR A:0x657580c0
y.create.l HWIO_RXFE_NB_WTR_START_ACTION_SAMPLE_NB2_ADDR A:0x657580c4
y.create.l HWIO_RXFE_NB_WTR_STOP_ACTION_SAMPLE_NB2_ADDR A:0x657580c8
y.create.l HWIO_RXFE_NB_WTR_STATUS_NB2_ADDR A:0x657580d0
y.create.l HWIO_RXFE_NB_WTR_ADDR_SNAPSHOT_NB2_ADDR A:0x657580d4
y.create.l HWIO_RXFE_NB_SPARE_REG_NB2_ADDR A:0x657580d8
y.create.l HWIO_RXFE_NB_TOP_CTL_NB3_ADDR A:0x65760000
y.create.l HWIO_RXFE_NB_GATE_CMD_NB3_ADDR A:0x65760004
y.create.l HWIO_RXFE_NB_GATE_STATUS_NB3_ADDR A:0x65760008
y.create.l HWIO_RXFE_NB_GATE_ACTION_SAMPLE_NB3_ADDR A:0x6576000c
y.create.l HWIO_RXFE_NB_TIMINGCTL_STATUS_NB3_ADDR A:0x65760010
y.create.l HWIO_RXFE_NB_CSR_CFG_NB3_ADDR A:0x65760014
y.create.l HWIO_RXFE_NB_CSR_CMD_NB3_ADDR A:0x65760018
y.create.l HWIO_RXFE_NB_CSR_PHASEUPDT_ACTION_SAMPLE_NB3_ADDR A:0x6576001c
y.create.l HWIO_RXFE_NB_CSR_FREQUPDT_ACTION_SAMPLE_NB3_ADDR A:0x65760020
y.create.l HWIO_RXFE_NB_CSR_PHASE_OFFSET_NB3_ADDR A:0x65760024
y.create.l HWIO_RXFE_NB_CSR_FREQ_OFFSET_NB3_ADDR A:0x65760028
y.create.l HWIO_RXFE_NB_CSR_CURR_PHASE_OFFSET_NB3_ADDR A:0x6576002c
y.create.l HWIO_RXFE_NB_CSR_CURR_FREQ_OFFSET_NB3_ADDR A:0x65760030
y.create.l HWIO_RXFE_NB_FILTERS_CFG_NB3_ADDR A:0x65760034
y.create.l HWIO_RXFE_NB_ICI_COEF0_NB3_ADDR A:0x6576003c
y.create.l HWIO_RXFE_NB_ICI_COEF1_NB3_ADDR A:0x65760040
y.create.l HWIO_RXFE_NB_ICI_COEF2_NB3_ADDR A:0x65760044
y.create.l HWIO_RXFE_NB_ICI_COEF3_NB3_ADDR A:0x65760048
y.create.l HWIO_RXFE_NB_ICI_COEF4_NB3_ADDR A:0x6576004c
y.create.l HWIO_RXFE_NB_ICI_COEF5_NB3_ADDR A:0x65760050
y.create.l HWIO_RXFE_NB_ICI_COEF6_NB3_ADDR A:0x65760054
y.create.l HWIO_RXFE_NB_ICI_COEF7_NB3_ADDR A:0x65760058
y.create.l HWIO_RXFE_NB_ICI_COEF8_NB3_ADDR A:0x6576005c
y.create.l HWIO_RXFE_NB_ICI_COEF9_NB3_ADDR A:0x65760060
y.create.l HWIO_RXFE_NB_GDA_NB3_ADDR A:0x65760068
y.create.l HWIO_RXFE_NB_NBDC_COMPVAL_I_NB3_ADDR A:0x6576006c
y.create.l HWIO_RXFE_NB_NBDC_COMPVAL_Q_NB3_ADDR A:0x65760070
y.create.l HWIO_RXFE_NB_NBPWR_CFG_NB3_ADDR A:0x65760074
y.create.l HWIO_RXFE_NB_NBPWR_CMD_NB3_ADDR A:0x65760078
y.create.l HWIO_RXFE_NB_NBPWR_START_ACTION_SAMPLE_NB3_ADDR A:0x6576007c
y.create.l HWIO_RXFE_NB_NBPWR_START_MASK_NB3_ADDR A:0x65760080
y.create.l HWIO_RXFE_NB_NBPWR_STOP_ACTION_SAMPLE_NB3_ADDR A:0x65760084
y.create.l HWIO_RXFE_NB_NBPWR_FINAL_ACC_NB3_ADDR A:0x65760088
y.create.l HWIO_RXFE_NB_NBPWR_CURR_ACC_NB3_ADDR A:0x6576008c
y.create.l HWIO_RXFE_NB_NBPWR_MAX_ACC_NB3_ADDR A:0x65760090
y.create.l HWIO_RXFE_NB_DVGA_CFG_NB3_ADDR A:0x65760094
y.create.l HWIO_RXFE_NB_DVGA_RXFE_GAIN_NB3_ADDR A:0x65760098
y.create.l HWIO_RXFE_NB_DVGA_OVERRIDE_DVGA_GAIN_NB3_ADDR A:0x6576009c
y.create.l HWIO_RXFE_NB_DVGA_CMD_NB3_ADDR A:0x657600a0
y.create.l HWIO_RXFE_NB_DVGA_UPDT_ACTION_SAMPLE_NB3_ADDR A:0x657600a4
y.create.l HWIO_RXFE_NB_DVGA_UPDT_MASK_NB3_ADDR A:0x657600a8
y.create.l HWIO_RXFE_NB_FINAL_BITWIDTHS_CFG_NB3_ADDR A:0x657600ac
y.create.l HWIO_RXFE_NB_WTR_CFG_NB3_ADDR A:0x657600b0
y.create.l HWIO_RXFE_NB_WTR_FUNC_CFG_NB3_ADDR A:0x657600b4
y.create.l HWIO_RXFE_NB_WTR_DBG_CFG0_NB3_ADDR A:0x657600b8
y.create.l HWIO_RXFE_NB_WTR_DBG_CFG1_NB3_ADDR A:0x657600bc
y.create.l HWIO_RXFE_NB_WTR_CMD_NB3_ADDR A:0x657600c0
y.create.l HWIO_RXFE_NB_WTR_START_ACTION_SAMPLE_NB3_ADDR A:0x657600c4
y.create.l HWIO_RXFE_NB_WTR_STOP_ACTION_SAMPLE_NB3_ADDR A:0x657600c8
y.create.l HWIO_RXFE_NB_WTR_STATUS_NB3_ADDR A:0x657600d0
y.create.l HWIO_RXFE_NB_WTR_ADDR_SNAPSHOT_NB3_ADDR A:0x657600d4
y.create.l HWIO_RXFE_NB_SPARE_REG_NB3_ADDR A:0x657600d8
y.create.l HWIO_RXFE_NB_TOP_CTL_NB4_ADDR A:0x65768000
y.create.l HWIO_RXFE_NB_GATE_CMD_NB4_ADDR A:0x65768004
y.create.l HWIO_RXFE_NB_GATE_STATUS_NB4_ADDR A:0x65768008
y.create.l HWIO_RXFE_NB_GATE_ACTION_SAMPLE_NB4_ADDR A:0x6576800c
y.create.l HWIO_RXFE_NB_TIMINGCTL_STATUS_NB4_ADDR A:0x65768010
y.create.l HWIO_RXFE_NB_CSR_CFG_NB4_ADDR A:0x65768014
y.create.l HWIO_RXFE_NB_CSR_CMD_NB4_ADDR A:0x65768018
y.create.l HWIO_RXFE_NB_CSR_PHASEUPDT_ACTION_SAMPLE_NB4_ADDR A:0x6576801c
y.create.l HWIO_RXFE_NB_CSR_FREQUPDT_ACTION_SAMPLE_NB4_ADDR A:0x65768020
y.create.l HWIO_RXFE_NB_CSR_PHASE_OFFSET_NB4_ADDR A:0x65768024
y.create.l HWIO_RXFE_NB_CSR_FREQ_OFFSET_NB4_ADDR A:0x65768028
y.create.l HWIO_RXFE_NB_CSR_CURR_PHASE_OFFSET_NB4_ADDR A:0x6576802c
y.create.l HWIO_RXFE_NB_CSR_CURR_FREQ_OFFSET_NB4_ADDR A:0x65768030
y.create.l HWIO_RXFE_NB_FILTERS_CFG_NB4_ADDR A:0x65768034
y.create.l HWIO_RXFE_NB_ICI_COEF0_NB4_ADDR A:0x6576803c
y.create.l HWIO_RXFE_NB_ICI_COEF1_NB4_ADDR A:0x65768040
y.create.l HWIO_RXFE_NB_ICI_COEF2_NB4_ADDR A:0x65768044
y.create.l HWIO_RXFE_NB_ICI_COEF3_NB4_ADDR A:0x65768048
y.create.l HWIO_RXFE_NB_ICI_COEF4_NB4_ADDR A:0x6576804c
y.create.l HWIO_RXFE_NB_ICI_COEF5_NB4_ADDR A:0x65768050
y.create.l HWIO_RXFE_NB_ICI_COEF6_NB4_ADDR A:0x65768054
y.create.l HWIO_RXFE_NB_ICI_COEF7_NB4_ADDR A:0x65768058
y.create.l HWIO_RXFE_NB_ICI_COEF8_NB4_ADDR A:0x6576805c
y.create.l HWIO_RXFE_NB_ICI_COEF9_NB4_ADDR A:0x65768060
y.create.l HWIO_RXFE_NB_GDA_NB4_ADDR A:0x65768068
y.create.l HWIO_RXFE_NB_NBDC_COMPVAL_I_NB4_ADDR A:0x6576806c
y.create.l HWIO_RXFE_NB_NBDC_COMPVAL_Q_NB4_ADDR A:0x65768070
y.create.l HWIO_RXFE_NB_NBPWR_CFG_NB4_ADDR A:0x65768074
y.create.l HWIO_RXFE_NB_NBPWR_CMD_NB4_ADDR A:0x65768078
y.create.l HWIO_RXFE_NB_NBPWR_START_ACTION_SAMPLE_NB4_ADDR A:0x6576807c
y.create.l HWIO_RXFE_NB_NBPWR_START_MASK_NB4_ADDR A:0x65768080
y.create.l HWIO_RXFE_NB_NBPWR_STOP_ACTION_SAMPLE_NB4_ADDR A:0x65768084
y.create.l HWIO_RXFE_NB_NBPWR_FINAL_ACC_NB4_ADDR A:0x65768088
y.create.l HWIO_RXFE_NB_NBPWR_CURR_ACC_NB4_ADDR A:0x6576808c
y.create.l HWIO_RXFE_NB_NBPWR_MAX_ACC_NB4_ADDR A:0x65768090
y.create.l HWIO_RXFE_NB_DVGA_CFG_NB4_ADDR A:0x65768094
y.create.l HWIO_RXFE_NB_DVGA_RXFE_GAIN_NB4_ADDR A:0x65768098
y.create.l HWIO_RXFE_NB_DVGA_OVERRIDE_DVGA_GAIN_NB4_ADDR A:0x6576809c
y.create.l HWIO_RXFE_NB_DVGA_CMD_NB4_ADDR A:0x657680a0
y.create.l HWIO_RXFE_NB_DVGA_UPDT_ACTION_SAMPLE_NB4_ADDR A:0x657680a4
y.create.l HWIO_RXFE_NB_DVGA_UPDT_MASK_NB4_ADDR A:0x657680a8
y.create.l HWIO_RXFE_NB_FINAL_BITWIDTHS_CFG_NB4_ADDR A:0x657680ac
y.create.l HWIO_RXFE_NB_WTR_CFG_NB4_ADDR A:0x657680b0
y.create.l HWIO_RXFE_NB_WTR_FUNC_CFG_NB4_ADDR A:0x657680b4
y.create.l HWIO_RXFE_NB_WTR_DBG_CFG0_NB4_ADDR A:0x657680b8
y.create.l HWIO_RXFE_NB_WTR_DBG_CFG1_NB4_ADDR A:0x657680bc
y.create.l HWIO_RXFE_NB_WTR_CMD_NB4_ADDR A:0x657680c0
y.create.l HWIO_RXFE_NB_WTR_START_ACTION_SAMPLE_NB4_ADDR A:0x657680c4
y.create.l HWIO_RXFE_NB_WTR_STOP_ACTION_SAMPLE_NB4_ADDR A:0x657680c8
y.create.l HWIO_RXFE_NB_WTR_STATUS_NB4_ADDR A:0x657680d0
y.create.l HWIO_RXFE_NB_WTR_ADDR_SNAPSHOT_NB4_ADDR A:0x657680d4
y.create.l HWIO_RXFE_NB_SPARE_REG_NB4_ADDR A:0x657680d8
y.create.l HWIO_RXFE_NB_TOP_CTL_NB5_ADDR A:0x65770000
y.create.l HWIO_RXFE_NB_GATE_CMD_NB5_ADDR A:0x65770004
y.create.l HWIO_RXFE_NB_GATE_STATUS_NB5_ADDR A:0x65770008
y.create.l HWIO_RXFE_NB_GATE_ACTION_SAMPLE_NB5_ADDR A:0x6577000c
y.create.l HWIO_RXFE_NB_TIMINGCTL_STATUS_NB5_ADDR A:0x65770010
y.create.l HWIO_RXFE_NB_CSR_CFG_NB5_ADDR A:0x65770014
y.create.l HWIO_RXFE_NB_CSR_CMD_NB5_ADDR A:0x65770018
y.create.l HWIO_RXFE_NB_CSR_PHASEUPDT_ACTION_SAMPLE_NB5_ADDR A:0x6577001c
y.create.l HWIO_RXFE_NB_CSR_FREQUPDT_ACTION_SAMPLE_NB5_ADDR A:0x65770020
y.create.l HWIO_RXFE_NB_CSR_PHASE_OFFSET_NB5_ADDR A:0x65770024
y.create.l HWIO_RXFE_NB_CSR_FREQ_OFFSET_NB5_ADDR A:0x65770028
y.create.l HWIO_RXFE_NB_CSR_CURR_PHASE_OFFSET_NB5_ADDR A:0x6577002c
y.create.l HWIO_RXFE_NB_CSR_CURR_FREQ_OFFSET_NB5_ADDR A:0x65770030
y.create.l HWIO_RXFE_NB_FILTERS_CFG_NB5_ADDR A:0x65770034
y.create.l HWIO_RXFE_NB_ICI_COEF0_NB5_ADDR A:0x6577003c
y.create.l HWIO_RXFE_NB_ICI_COEF1_NB5_ADDR A:0x65770040
y.create.l HWIO_RXFE_NB_ICI_COEF2_NB5_ADDR A:0x65770044
y.create.l HWIO_RXFE_NB_ICI_COEF3_NB5_ADDR A:0x65770048
y.create.l HWIO_RXFE_NB_ICI_COEF4_NB5_ADDR A:0x6577004c
y.create.l HWIO_RXFE_NB_ICI_COEF5_NB5_ADDR A:0x65770050
y.create.l HWIO_RXFE_NB_ICI_COEF6_NB5_ADDR A:0x65770054
y.create.l HWIO_RXFE_NB_ICI_COEF7_NB5_ADDR A:0x65770058
y.create.l HWIO_RXFE_NB_ICI_COEF8_NB5_ADDR A:0x6577005c
y.create.l HWIO_RXFE_NB_ICI_COEF9_NB5_ADDR A:0x65770060
y.create.l HWIO_RXFE_NB_GDA_NB5_ADDR A:0x65770068
y.create.l HWIO_RXFE_NB_NBDC_COMPVAL_I_NB5_ADDR A:0x6577006c
y.create.l HWIO_RXFE_NB_NBDC_COMPVAL_Q_NB5_ADDR A:0x65770070
y.create.l HWIO_RXFE_NB_NBPWR_CFG_NB5_ADDR A:0x65770074
y.create.l HWIO_RXFE_NB_NBPWR_CMD_NB5_ADDR A:0x65770078
y.create.l HWIO_RXFE_NB_NBPWR_START_ACTION_SAMPLE_NB5_ADDR A:0x6577007c
y.create.l HWIO_RXFE_NB_NBPWR_START_MASK_NB5_ADDR A:0x65770080
y.create.l HWIO_RXFE_NB_NBPWR_STOP_ACTION_SAMPLE_NB5_ADDR A:0x65770084
y.create.l HWIO_RXFE_NB_NBPWR_FINAL_ACC_NB5_ADDR A:0x65770088
y.create.l HWIO_RXFE_NB_NBPWR_CURR_ACC_NB5_ADDR A:0x6577008c
y.create.l HWIO_RXFE_NB_NBPWR_MAX_ACC_NB5_ADDR A:0x65770090
y.create.l HWIO_RXFE_NB_DVGA_CFG_NB5_ADDR A:0x65770094
y.create.l HWIO_RXFE_NB_DVGA_RXFE_GAIN_NB5_ADDR A:0x65770098
y.create.l HWIO_RXFE_NB_DVGA_OVERRIDE_DVGA_GAIN_NB5_ADDR A:0x6577009c
y.create.l HWIO_RXFE_NB_DVGA_CMD_NB5_ADDR A:0x657700a0
y.create.l HWIO_RXFE_NB_DVGA_UPDT_ACTION_SAMPLE_NB5_ADDR A:0x657700a4
y.create.l HWIO_RXFE_NB_DVGA_UPDT_MASK_NB5_ADDR A:0x657700a8
y.create.l HWIO_RXFE_NB_FINAL_BITWIDTHS_CFG_NB5_ADDR A:0x657700ac
y.create.l HWIO_RXFE_NB_WTR_CFG_NB5_ADDR A:0x657700b0
y.create.l HWIO_RXFE_NB_WTR_FUNC_CFG_NB5_ADDR A:0x657700b4
y.create.l HWIO_RXFE_NB_WTR_DBG_CFG0_NB5_ADDR A:0x657700b8
y.create.l HWIO_RXFE_NB_WTR_DBG_CFG1_NB5_ADDR A:0x657700bc
y.create.l HWIO_RXFE_NB_WTR_CMD_NB5_ADDR A:0x657700c0
y.create.l HWIO_RXFE_NB_WTR_START_ACTION_SAMPLE_NB5_ADDR A:0x657700c4
y.create.l HWIO_RXFE_NB_WTR_STOP_ACTION_SAMPLE_NB5_ADDR A:0x657700c8
y.create.l HWIO_RXFE_NB_WTR_STATUS_NB5_ADDR A:0x657700d0
y.create.l HWIO_RXFE_NB_WTR_ADDR_SNAPSHOT_NB5_ADDR A:0x657700d4
y.create.l HWIO_RXFE_NB_SPARE_REG_NB5_ADDR A:0x657700d8
y.create.l HWIO_RXFE_NB_TOP_CTL_NB6_ADDR A:0x65778000
y.create.l HWIO_RXFE_NB_GATE_CMD_NB6_ADDR A:0x65778004
y.create.l HWIO_RXFE_NB_GATE_STATUS_NB6_ADDR A:0x65778008
y.create.l HWIO_RXFE_NB_GATE_ACTION_SAMPLE_NB6_ADDR A:0x6577800c
y.create.l HWIO_RXFE_NB_TIMINGCTL_STATUS_NB6_ADDR A:0x65778010
y.create.l HWIO_RXFE_NB_CSR_CFG_NB6_ADDR A:0x65778014
y.create.l HWIO_RXFE_NB_CSR_CMD_NB6_ADDR A:0x65778018
y.create.l HWIO_RXFE_NB_CSR_PHASEUPDT_ACTION_SAMPLE_NB6_ADDR A:0x6577801c
y.create.l HWIO_RXFE_NB_CSR_FREQUPDT_ACTION_SAMPLE_NB6_ADDR A:0x65778020
y.create.l HWIO_RXFE_NB_CSR_PHASE_OFFSET_NB6_ADDR A:0x65778024
y.create.l HWIO_RXFE_NB_CSR_FREQ_OFFSET_NB6_ADDR A:0x65778028
y.create.l HWIO_RXFE_NB_CSR_CURR_PHASE_OFFSET_NB6_ADDR A:0x6577802c
y.create.l HWIO_RXFE_NB_CSR_CURR_FREQ_OFFSET_NB6_ADDR A:0x65778030
y.create.l HWIO_RXFE_NB_FILTERS_CFG_NB6_ADDR A:0x65778034
y.create.l HWIO_RXFE_NB_ICI_COEF0_NB6_ADDR A:0x6577803c
y.create.l HWIO_RXFE_NB_ICI_COEF1_NB6_ADDR A:0x65778040
y.create.l HWIO_RXFE_NB_ICI_COEF2_NB6_ADDR A:0x65778044
y.create.l HWIO_RXFE_NB_ICI_COEF3_NB6_ADDR A:0x65778048
y.create.l HWIO_RXFE_NB_ICI_COEF4_NB6_ADDR A:0x6577804c
y.create.l HWIO_RXFE_NB_ICI_COEF5_NB6_ADDR A:0x65778050
y.create.l HWIO_RXFE_NB_ICI_COEF6_NB6_ADDR A:0x65778054
y.create.l HWIO_RXFE_NB_ICI_COEF7_NB6_ADDR A:0x65778058
y.create.l HWIO_RXFE_NB_ICI_COEF8_NB6_ADDR A:0x6577805c
y.create.l HWIO_RXFE_NB_ICI_COEF9_NB6_ADDR A:0x65778060
y.create.l HWIO_RXFE_NB_GDA_NB6_ADDR A:0x65778068
y.create.l HWIO_RXFE_NB_NBDC_COMPVAL_I_NB6_ADDR A:0x6577806c
y.create.l HWIO_RXFE_NB_NBDC_COMPVAL_Q_NB6_ADDR A:0x65778070
y.create.l HWIO_RXFE_NB_NBPWR_CFG_NB6_ADDR A:0x65778074
y.create.l HWIO_RXFE_NB_NBPWR_CMD_NB6_ADDR A:0x65778078
y.create.l HWIO_RXFE_NB_NBPWR_START_ACTION_SAMPLE_NB6_ADDR A:0x6577807c
y.create.l HWIO_RXFE_NB_NBPWR_START_MASK_NB6_ADDR A:0x65778080
y.create.l HWIO_RXFE_NB_NBPWR_STOP_ACTION_SAMPLE_NB6_ADDR A:0x65778084
y.create.l HWIO_RXFE_NB_NBPWR_FINAL_ACC_NB6_ADDR A:0x65778088
y.create.l HWIO_RXFE_NB_NBPWR_CURR_ACC_NB6_ADDR A:0x6577808c
y.create.l HWIO_RXFE_NB_NBPWR_MAX_ACC_NB6_ADDR A:0x65778090
y.create.l HWIO_RXFE_NB_DVGA_CFG_NB6_ADDR A:0x65778094
y.create.l HWIO_RXFE_NB_DVGA_RXFE_GAIN_NB6_ADDR A:0x65778098
y.create.l HWIO_RXFE_NB_DVGA_OVERRIDE_DVGA_GAIN_NB6_ADDR A:0x6577809c
y.create.l HWIO_RXFE_NB_DVGA_CMD_NB6_ADDR A:0x657780a0
y.create.l HWIO_RXFE_NB_DVGA_UPDT_ACTION_SAMPLE_NB6_ADDR A:0x657780a4
y.create.l HWIO_RXFE_NB_DVGA_UPDT_MASK_NB6_ADDR A:0x657780a8
y.create.l HWIO_RXFE_NB_FINAL_BITWIDTHS_CFG_NB6_ADDR A:0x657780ac
y.create.l HWIO_RXFE_NB_WTR_CFG_NB6_ADDR A:0x657780b0
y.create.l HWIO_RXFE_NB_WTR_FUNC_CFG_NB6_ADDR A:0x657780b4
y.create.l HWIO_RXFE_NB_WTR_DBG_CFG0_NB6_ADDR A:0x657780b8
y.create.l HWIO_RXFE_NB_WTR_DBG_CFG1_NB6_ADDR A:0x657780bc
y.create.l HWIO_RXFE_NB_WTR_CMD_NB6_ADDR A:0x657780c0
y.create.l HWIO_RXFE_NB_WTR_START_ACTION_SAMPLE_NB6_ADDR A:0x657780c4
y.create.l HWIO_RXFE_NB_WTR_STOP_ACTION_SAMPLE_NB6_ADDR A:0x657780c8
y.create.l HWIO_RXFE_NB_WTR_STATUS_NB6_ADDR A:0x657780d0
y.create.l HWIO_RXFE_NB_WTR_ADDR_SNAPSHOT_NB6_ADDR A:0x657780d4
y.create.l HWIO_RXFE_NB_SPARE_REG_NB6_ADDR A:0x657780d8
y.create.l HWIO_RXFE_NB_TOP_CTL_NB7_ADDR A:0x65780000
y.create.l HWIO_RXFE_NB_GATE_CMD_NB7_ADDR A:0x65780004
y.create.l HWIO_RXFE_NB_GATE_STATUS_NB7_ADDR A:0x65780008
y.create.l HWIO_RXFE_NB_GATE_ACTION_SAMPLE_NB7_ADDR A:0x6578000c
y.create.l HWIO_RXFE_NB_TIMINGCTL_STATUS_NB7_ADDR A:0x65780010
y.create.l HWIO_RXFE_NB_CSR_CFG_NB7_ADDR A:0x65780014
y.create.l HWIO_RXFE_NB_CSR_CMD_NB7_ADDR A:0x65780018
y.create.l HWIO_RXFE_NB_CSR_PHASEUPDT_ACTION_SAMPLE_NB7_ADDR A:0x6578001c
y.create.l HWIO_RXFE_NB_CSR_FREQUPDT_ACTION_SAMPLE_NB7_ADDR A:0x65780020
y.create.l HWIO_RXFE_NB_CSR_PHASE_OFFSET_NB7_ADDR A:0x65780024
y.create.l HWIO_RXFE_NB_CSR_FREQ_OFFSET_NB7_ADDR A:0x65780028
y.create.l HWIO_RXFE_NB_CSR_CURR_PHASE_OFFSET_NB7_ADDR A:0x6578002c
y.create.l HWIO_RXFE_NB_CSR_CURR_FREQ_OFFSET_NB7_ADDR A:0x65780030
y.create.l HWIO_RXFE_NB_FILTERS_CFG_NB7_ADDR A:0x65780034
y.create.l HWIO_RXFE_NB_ICI_COEF0_NB7_ADDR A:0x6578003c
y.create.l HWIO_RXFE_NB_ICI_COEF1_NB7_ADDR A:0x65780040
y.create.l HWIO_RXFE_NB_ICI_COEF2_NB7_ADDR A:0x65780044
y.create.l HWIO_RXFE_NB_ICI_COEF3_NB7_ADDR A:0x65780048
y.create.l HWIO_RXFE_NB_ICI_COEF4_NB7_ADDR A:0x6578004c
y.create.l HWIO_RXFE_NB_ICI_COEF5_NB7_ADDR A:0x65780050
y.create.l HWIO_RXFE_NB_ICI_COEF6_NB7_ADDR A:0x65780054
y.create.l HWIO_RXFE_NB_ICI_COEF7_NB7_ADDR A:0x65780058
y.create.l HWIO_RXFE_NB_ICI_COEF8_NB7_ADDR A:0x6578005c
y.create.l HWIO_RXFE_NB_ICI_COEF9_NB7_ADDR A:0x65780060
y.create.l HWIO_RXFE_NB_GDA_NB7_ADDR A:0x65780068
y.create.l HWIO_RXFE_NB_NBDC_COMPVAL_I_NB7_ADDR A:0x6578006c
y.create.l HWIO_RXFE_NB_NBDC_COMPVAL_Q_NB7_ADDR A:0x65780070
y.create.l HWIO_RXFE_NB_NBPWR_CFG_NB7_ADDR A:0x65780074
y.create.l HWIO_RXFE_NB_NBPWR_CMD_NB7_ADDR A:0x65780078
y.create.l HWIO_RXFE_NB_NBPWR_START_ACTION_SAMPLE_NB7_ADDR A:0x6578007c
y.create.l HWIO_RXFE_NB_NBPWR_START_MASK_NB7_ADDR A:0x65780080
y.create.l HWIO_RXFE_NB_NBPWR_STOP_ACTION_SAMPLE_NB7_ADDR A:0x65780084
y.create.l HWIO_RXFE_NB_NBPWR_FINAL_ACC_NB7_ADDR A:0x65780088
y.create.l HWIO_RXFE_NB_NBPWR_CURR_ACC_NB7_ADDR A:0x6578008c
y.create.l HWIO_RXFE_NB_NBPWR_MAX_ACC_NB7_ADDR A:0x65780090
y.create.l HWIO_RXFE_NB_DVGA_CFG_NB7_ADDR A:0x65780094
y.create.l HWIO_RXFE_NB_DVGA_RXFE_GAIN_NB7_ADDR A:0x65780098
y.create.l HWIO_RXFE_NB_DVGA_OVERRIDE_DVGA_GAIN_NB7_ADDR A:0x6578009c
y.create.l HWIO_RXFE_NB_DVGA_CMD_NB7_ADDR A:0x657800a0
y.create.l HWIO_RXFE_NB_DVGA_UPDT_ACTION_SAMPLE_NB7_ADDR A:0x657800a4
y.create.l HWIO_RXFE_NB_DVGA_UPDT_MASK_NB7_ADDR A:0x657800a8
y.create.l HWIO_RXFE_NB_FINAL_BITWIDTHS_CFG_NB7_ADDR A:0x657800ac
y.create.l HWIO_RXFE_NB_WTR_CFG_NB7_ADDR A:0x657800b0
y.create.l HWIO_RXFE_NB_WTR_FUNC_CFG_NB7_ADDR A:0x657800b4
y.create.l HWIO_RXFE_NB_WTR_DBG_CFG0_NB7_ADDR A:0x657800b8
y.create.l HWIO_RXFE_NB_WTR_DBG_CFG1_NB7_ADDR A:0x657800bc
y.create.l HWIO_RXFE_NB_WTR_CMD_NB7_ADDR A:0x657800c0
y.create.l HWIO_RXFE_NB_WTR_START_ACTION_SAMPLE_NB7_ADDR A:0x657800c4
y.create.l HWIO_RXFE_NB_WTR_STOP_ACTION_SAMPLE_NB7_ADDR A:0x657800c8
y.create.l HWIO_RXFE_NB_WTR_STATUS_NB7_ADDR A:0x657800d0
y.create.l HWIO_RXFE_NB_WTR_ADDR_SNAPSHOT_NB7_ADDR A:0x657800d4
y.create.l HWIO_RXFE_NB_SPARE_REG_NB7_ADDR A:0x657800d8
y.create.l HWIO_RXFE_NB_TOP_CTL_NB8_ADDR A:0x65788000
y.create.l HWIO_RXFE_NB_GATE_CMD_NB8_ADDR A:0x65788004
y.create.l HWIO_RXFE_NB_GATE_STATUS_NB8_ADDR A:0x65788008
y.create.l HWIO_RXFE_NB_GATE_ACTION_SAMPLE_NB8_ADDR A:0x6578800c
y.create.l HWIO_RXFE_NB_TIMINGCTL_STATUS_NB8_ADDR A:0x65788010
y.create.l HWIO_RXFE_NB_CSR_CFG_NB8_ADDR A:0x65788014
y.create.l HWIO_RXFE_NB_CSR_CMD_NB8_ADDR A:0x65788018
y.create.l HWIO_RXFE_NB_CSR_PHASEUPDT_ACTION_SAMPLE_NB8_ADDR A:0x6578801c
y.create.l HWIO_RXFE_NB_CSR_FREQUPDT_ACTION_SAMPLE_NB8_ADDR A:0x65788020
y.create.l HWIO_RXFE_NB_CSR_PHASE_OFFSET_NB8_ADDR A:0x65788024
y.create.l HWIO_RXFE_NB_CSR_FREQ_OFFSET_NB8_ADDR A:0x65788028
y.create.l HWIO_RXFE_NB_CSR_CURR_PHASE_OFFSET_NB8_ADDR A:0x6578802c
y.create.l HWIO_RXFE_NB_CSR_CURR_FREQ_OFFSET_NB8_ADDR A:0x65788030
y.create.l HWIO_RXFE_NB_FILTERS_CFG_NB8_ADDR A:0x65788034
y.create.l HWIO_RXFE_NB_ICI_COEF0_NB8_ADDR A:0x6578803c
y.create.l HWIO_RXFE_NB_ICI_COEF1_NB8_ADDR A:0x65788040
y.create.l HWIO_RXFE_NB_ICI_COEF2_NB8_ADDR A:0x65788044
y.create.l HWIO_RXFE_NB_ICI_COEF3_NB8_ADDR A:0x65788048
y.create.l HWIO_RXFE_NB_ICI_COEF4_NB8_ADDR A:0x6578804c
y.create.l HWIO_RXFE_NB_ICI_COEF5_NB8_ADDR A:0x65788050
y.create.l HWIO_RXFE_NB_ICI_COEF6_NB8_ADDR A:0x65788054
y.create.l HWIO_RXFE_NB_ICI_COEF7_NB8_ADDR A:0x65788058
y.create.l HWIO_RXFE_NB_ICI_COEF8_NB8_ADDR A:0x6578805c
y.create.l HWIO_RXFE_NB_ICI_COEF9_NB8_ADDR A:0x65788060
y.create.l HWIO_RXFE_NB_GDA_NB8_ADDR A:0x65788068
y.create.l HWIO_RXFE_NB_NBDC_COMPVAL_I_NB8_ADDR A:0x6578806c
y.create.l HWIO_RXFE_NB_NBDC_COMPVAL_Q_NB8_ADDR A:0x65788070
y.create.l HWIO_RXFE_NB_NBPWR_CFG_NB8_ADDR A:0x65788074
y.create.l HWIO_RXFE_NB_NBPWR_CMD_NB8_ADDR A:0x65788078
y.create.l HWIO_RXFE_NB_NBPWR_START_ACTION_SAMPLE_NB8_ADDR A:0x6578807c
y.create.l HWIO_RXFE_NB_NBPWR_START_MASK_NB8_ADDR A:0x65788080
y.create.l HWIO_RXFE_NB_NBPWR_STOP_ACTION_SAMPLE_NB8_ADDR A:0x65788084
y.create.l HWIO_RXFE_NB_NBPWR_FINAL_ACC_NB8_ADDR A:0x65788088
y.create.l HWIO_RXFE_NB_NBPWR_CURR_ACC_NB8_ADDR A:0x6578808c
y.create.l HWIO_RXFE_NB_NBPWR_MAX_ACC_NB8_ADDR A:0x65788090
y.create.l HWIO_RXFE_NB_DVGA_CFG_NB8_ADDR A:0x65788094
y.create.l HWIO_RXFE_NB_DVGA_RXFE_GAIN_NB8_ADDR A:0x65788098
y.create.l HWIO_RXFE_NB_DVGA_OVERRIDE_DVGA_GAIN_NB8_ADDR A:0x6578809c
y.create.l HWIO_RXFE_NB_DVGA_CMD_NB8_ADDR A:0x657880a0
y.create.l HWIO_RXFE_NB_DVGA_UPDT_ACTION_SAMPLE_NB8_ADDR A:0x657880a4
y.create.l HWIO_RXFE_NB_DVGA_UPDT_MASK_NB8_ADDR A:0x657880a8
y.create.l HWIO_RXFE_NB_FINAL_BITWIDTHS_CFG_NB8_ADDR A:0x657880ac
y.create.l HWIO_RXFE_NB_WTR_CFG_NB8_ADDR A:0x657880b0
y.create.l HWIO_RXFE_NB_WTR_FUNC_CFG_NB8_ADDR A:0x657880b4
y.create.l HWIO_RXFE_NB_WTR_DBG_CFG0_NB8_ADDR A:0x657880b8
y.create.l HWIO_RXFE_NB_WTR_DBG_CFG1_NB8_ADDR A:0x657880bc
y.create.l HWIO_RXFE_NB_WTR_CMD_NB8_ADDR A:0x657880c0
y.create.l HWIO_RXFE_NB_WTR_START_ACTION_SAMPLE_NB8_ADDR A:0x657880c4
y.create.l HWIO_RXFE_NB_WTR_STOP_ACTION_SAMPLE_NB8_ADDR A:0x657880c8
y.create.l HWIO_RXFE_NB_WTR_STATUS_NB8_ADDR A:0x657880d0
y.create.l HWIO_RXFE_NB_WTR_ADDR_SNAPSHOT_NB8_ADDR A:0x657880d4
y.create.l HWIO_RXFE_NB_SPARE_REG_NB8_ADDR A:0x657880d8
y.create.l HWIO_RXFE_NB_TOP_CTL_NB9_ADDR A:0x65790000
y.create.l HWIO_RXFE_NB_GATE_CMD_NB9_ADDR A:0x65790004
y.create.l HWIO_RXFE_NB_GATE_STATUS_NB9_ADDR A:0x65790008
y.create.l HWIO_RXFE_NB_GATE_ACTION_SAMPLE_NB9_ADDR A:0x6579000c
y.create.l HWIO_RXFE_NB_TIMINGCTL_STATUS_NB9_ADDR A:0x65790010
y.create.l HWIO_RXFE_NB_CSR_CFG_NB9_ADDR A:0x65790014
y.create.l HWIO_RXFE_NB_CSR_CMD_NB9_ADDR A:0x65790018
y.create.l HWIO_RXFE_NB_CSR_PHASEUPDT_ACTION_SAMPLE_NB9_ADDR A:0x6579001c
y.create.l HWIO_RXFE_NB_CSR_FREQUPDT_ACTION_SAMPLE_NB9_ADDR A:0x65790020
y.create.l HWIO_RXFE_NB_CSR_PHASE_OFFSET_NB9_ADDR A:0x65790024
y.create.l HWIO_RXFE_NB_CSR_FREQ_OFFSET_NB9_ADDR A:0x65790028
y.create.l HWIO_RXFE_NB_CSR_CURR_PHASE_OFFSET_NB9_ADDR A:0x6579002c
y.create.l HWIO_RXFE_NB_CSR_CURR_FREQ_OFFSET_NB9_ADDR A:0x65790030
y.create.l HWIO_RXFE_NB_FILTERS_CFG_NB9_ADDR A:0x65790034
y.create.l HWIO_RXFE_NB_ICI_COEF0_NB9_ADDR A:0x6579003c
y.create.l HWIO_RXFE_NB_ICI_COEF1_NB9_ADDR A:0x65790040
y.create.l HWIO_RXFE_NB_ICI_COEF2_NB9_ADDR A:0x65790044
y.create.l HWIO_RXFE_NB_ICI_COEF3_NB9_ADDR A:0x65790048
y.create.l HWIO_RXFE_NB_ICI_COEF4_NB9_ADDR A:0x6579004c
y.create.l HWIO_RXFE_NB_ICI_COEF5_NB9_ADDR A:0x65790050
y.create.l HWIO_RXFE_NB_ICI_COEF6_NB9_ADDR A:0x65790054
y.create.l HWIO_RXFE_NB_ICI_COEF7_NB9_ADDR A:0x65790058
y.create.l HWIO_RXFE_NB_ICI_COEF8_NB9_ADDR A:0x6579005c
y.create.l HWIO_RXFE_NB_ICI_COEF9_NB9_ADDR A:0x65790060
y.create.l HWIO_RXFE_NB_GDA_NB9_ADDR A:0x65790068
y.create.l HWIO_RXFE_NB_NBDC_COMPVAL_I_NB9_ADDR A:0x6579006c
y.create.l HWIO_RXFE_NB_NBDC_COMPVAL_Q_NB9_ADDR A:0x65790070
y.create.l HWIO_RXFE_NB_NBPWR_CFG_NB9_ADDR A:0x65790074
y.create.l HWIO_RXFE_NB_NBPWR_CMD_NB9_ADDR A:0x65790078
y.create.l HWIO_RXFE_NB_NBPWR_START_ACTION_SAMPLE_NB9_ADDR A:0x6579007c
y.create.l HWIO_RXFE_NB_NBPWR_START_MASK_NB9_ADDR A:0x65790080
y.create.l HWIO_RXFE_NB_NBPWR_STOP_ACTION_SAMPLE_NB9_ADDR A:0x65790084
y.create.l HWIO_RXFE_NB_NBPWR_FINAL_ACC_NB9_ADDR A:0x65790088
y.create.l HWIO_RXFE_NB_NBPWR_CURR_ACC_NB9_ADDR A:0x6579008c
y.create.l HWIO_RXFE_NB_NBPWR_MAX_ACC_NB9_ADDR A:0x65790090
y.create.l HWIO_RXFE_NB_DVGA_CFG_NB9_ADDR A:0x65790094
y.create.l HWIO_RXFE_NB_DVGA_RXFE_GAIN_NB9_ADDR A:0x65790098
y.create.l HWIO_RXFE_NB_DVGA_OVERRIDE_DVGA_GAIN_NB9_ADDR A:0x6579009c
y.create.l HWIO_RXFE_NB_DVGA_CMD_NB9_ADDR A:0x657900a0
y.create.l HWIO_RXFE_NB_DVGA_UPDT_ACTION_SAMPLE_NB9_ADDR A:0x657900a4
y.create.l HWIO_RXFE_NB_DVGA_UPDT_MASK_NB9_ADDR A:0x657900a8
y.create.l HWIO_RXFE_NB_FINAL_BITWIDTHS_CFG_NB9_ADDR A:0x657900ac
y.create.l HWIO_RXFE_NB_WTR_CFG_NB9_ADDR A:0x657900b0
y.create.l HWIO_RXFE_NB_WTR_FUNC_CFG_NB9_ADDR A:0x657900b4
y.create.l HWIO_RXFE_NB_WTR_DBG_CFG0_NB9_ADDR A:0x657900b8
y.create.l HWIO_RXFE_NB_WTR_DBG_CFG1_NB9_ADDR A:0x657900bc
y.create.l HWIO_RXFE_NB_WTR_CMD_NB9_ADDR A:0x657900c0
y.create.l HWIO_RXFE_NB_WTR_START_ACTION_SAMPLE_NB9_ADDR A:0x657900c4
y.create.l HWIO_RXFE_NB_WTR_STOP_ACTION_SAMPLE_NB9_ADDR A:0x657900c8
y.create.l HWIO_RXFE_NB_WTR_STATUS_NB9_ADDR A:0x657900d0
y.create.l HWIO_RXFE_NB_WTR_ADDR_SNAPSHOT_NB9_ADDR A:0x657900d4
y.create.l HWIO_RXFE_NB_SPARE_REG_NB9_ADDR A:0x657900d8
y.create.l HWIO_RXFE_NB_TOP_CTL_NB10_ADDR A:0x65798000
y.create.l HWIO_RXFE_NB_GATE_CMD_NB10_ADDR A:0x65798004
y.create.l HWIO_RXFE_NB_GATE_STATUS_NB10_ADDR A:0x65798008
y.create.l HWIO_RXFE_NB_GATE_ACTION_SAMPLE_NB10_ADDR A:0x6579800c
y.create.l HWIO_RXFE_NB_TIMINGCTL_STATUS_NB10_ADDR A:0x65798010
y.create.l HWIO_RXFE_NB_CSR_CFG_NB10_ADDR A:0x65798014
y.create.l HWIO_RXFE_NB_CSR_CMD_NB10_ADDR A:0x65798018
y.create.l HWIO_RXFE_NB_CSR_PHASEUPDT_ACTION_SAMPLE_NB10_ADDR A:0x6579801c
y.create.l HWIO_RXFE_NB_CSR_FREQUPDT_ACTION_SAMPLE_NB10_ADDR A:0x65798020
y.create.l HWIO_RXFE_NB_CSR_PHASE_OFFSET_NB10_ADDR A:0x65798024
y.create.l HWIO_RXFE_NB_CSR_FREQ_OFFSET_NB10_ADDR A:0x65798028
y.create.l HWIO_RXFE_NB_CSR_CURR_PHASE_OFFSET_NB10_ADDR A:0x6579802c
y.create.l HWIO_RXFE_NB_CSR_CURR_FREQ_OFFSET_NB10_ADDR A:0x65798030
y.create.l HWIO_RXFE_NB_FILTERS_CFG_NB10_ADDR A:0x65798034
y.create.l HWIO_RXFE_NB_ICI_COEF0_NB10_ADDR A:0x6579803c
y.create.l HWIO_RXFE_NB_ICI_COEF1_NB10_ADDR A:0x65798040
y.create.l HWIO_RXFE_NB_ICI_COEF2_NB10_ADDR A:0x65798044
y.create.l HWIO_RXFE_NB_ICI_COEF3_NB10_ADDR A:0x65798048
y.create.l HWIO_RXFE_NB_ICI_COEF4_NB10_ADDR A:0x6579804c
y.create.l HWIO_RXFE_NB_ICI_COEF5_NB10_ADDR A:0x65798050
y.create.l HWIO_RXFE_NB_ICI_COEF6_NB10_ADDR A:0x65798054
y.create.l HWIO_RXFE_NB_ICI_COEF7_NB10_ADDR A:0x65798058
y.create.l HWIO_RXFE_NB_ICI_COEF8_NB10_ADDR A:0x6579805c
y.create.l HWIO_RXFE_NB_ICI_COEF9_NB10_ADDR A:0x65798060
y.create.l HWIO_RXFE_NB_GDA_NB10_ADDR A:0x65798068
y.create.l HWIO_RXFE_NB_NBDC_COMPVAL_I_NB10_ADDR A:0x6579806c
y.create.l HWIO_RXFE_NB_NBDC_COMPVAL_Q_NB10_ADDR A:0x65798070
y.create.l HWIO_RXFE_NB_NBPWR_CFG_NB10_ADDR A:0x65798074
y.create.l HWIO_RXFE_NB_NBPWR_CMD_NB10_ADDR A:0x65798078
y.create.l HWIO_RXFE_NB_NBPWR_START_ACTION_SAMPLE_NB10_ADDR A:0x6579807c
y.create.l HWIO_RXFE_NB_NBPWR_START_MASK_NB10_ADDR A:0x65798080
y.create.l HWIO_RXFE_NB_NBPWR_STOP_ACTION_SAMPLE_NB10_ADDR A:0x65798084
y.create.l HWIO_RXFE_NB_NBPWR_FINAL_ACC_NB10_ADDR A:0x65798088
y.create.l HWIO_RXFE_NB_NBPWR_CURR_ACC_NB10_ADDR A:0x6579808c
y.create.l HWIO_RXFE_NB_NBPWR_MAX_ACC_NB10_ADDR A:0x65798090
y.create.l HWIO_RXFE_NB_DVGA_CFG_NB10_ADDR A:0x65798094
y.create.l HWIO_RXFE_NB_DVGA_RXFE_GAIN_NB10_ADDR A:0x65798098
y.create.l HWIO_RXFE_NB_DVGA_OVERRIDE_DVGA_GAIN_NB10_ADDR A:0x6579809c
y.create.l HWIO_RXFE_NB_DVGA_CMD_NB10_ADDR A:0x657980a0
y.create.l HWIO_RXFE_NB_DVGA_UPDT_ACTION_SAMPLE_NB10_ADDR A:0x657980a4
y.create.l HWIO_RXFE_NB_DVGA_UPDT_MASK_NB10_ADDR A:0x657980a8
y.create.l HWIO_RXFE_NB_FINAL_BITWIDTHS_CFG_NB10_ADDR A:0x657980ac
y.create.l HWIO_RXFE_NB_WTR_CFG_NB10_ADDR A:0x657980b0
y.create.l HWIO_RXFE_NB_WTR_FUNC_CFG_NB10_ADDR A:0x657980b4
y.create.l HWIO_RXFE_NB_WTR_DBG_CFG0_NB10_ADDR A:0x657980b8
y.create.l HWIO_RXFE_NB_WTR_DBG_CFG1_NB10_ADDR A:0x657980bc
y.create.l HWIO_RXFE_NB_WTR_CMD_NB10_ADDR A:0x657980c0
y.create.l HWIO_RXFE_NB_WTR_START_ACTION_SAMPLE_NB10_ADDR A:0x657980c4
y.create.l HWIO_RXFE_NB_WTR_STOP_ACTION_SAMPLE_NB10_ADDR A:0x657980c8
y.create.l HWIO_RXFE_NB_WTR_STATUS_NB10_ADDR A:0x657980d0
y.create.l HWIO_RXFE_NB_WTR_ADDR_SNAPSHOT_NB10_ADDR A:0x657980d4
y.create.l HWIO_RXFE_NB_SPARE_REG_NB10_ADDR A:0x657980d8
y.create.l HWIO_DTR_TXFE0_START_ADDR A:0x657a0000
y.create.l HWIO_DTR_TXFE0_START_DAC_CLK_OFFSET_ADDR A:0x657a0004
y.create.l HWIO_DTR_TXFE0_STOP_ADDR A:0x657a0008
y.create.l HWIO_DTR_DAC0_IREF_UPDATE_START_ADDR A:0x657a0024
y.create.l HWIO_DTR_DAC0_IREF_UPDATE_STOP_ADDR A:0x657a0028
y.create.l HWIO_DTR_TXFE0_IMMEDIATE_UPDATE_EN_ADDR A:0x657a002c
y.create.l HWIO_DTR_TXFE0_CURRENT_SAMPLE_COUNT_ADDR A:0x657a0030
y.create.l HWIO_DTR_TXFE0_CALIBRATION_MODE_ADDR A:0x657a003c
y.create.l HWIO_DTR_TXFE1_START_ADDR A:0x657a0040
y.create.l HWIO_DTR_TXFE1_START_DAC_CLK_OFFSET_ADDR A:0x657a0044
y.create.l HWIO_DTR_TXFE1_STOP_ADDR A:0x657a0048
y.create.l HWIO_DTR_DAC1_IREF_UPDATE_START_ADDR A:0x657a0064
y.create.l HWIO_DTR_DAC1_IREF_UPDATE_STOP_ADDR A:0x657a0068
y.create.l HWIO_DTR_TXFE1_IMMEDIATE_UPDATE_EN_ADDR A:0x657a006c
y.create.l HWIO_DTR_TXFE1_CURRENT_SAMPLE_COUNT_ADDR A:0x657a0078
y.create.l HWIO_DTR_TXFE1_CALIBRATION_MODE_ADDR A:0x657a007c
y.create.l HWIO_DTR_EVT_UNUSED0_ADDR A:0x657a0080
y.create.l HWIO_DTR_EVT_UNUSED1_ADDR A:0x657a0084
y.create.l HWIO_DTR_EVT_UNUSED2_ADDR A:0x657a0088
y.create.l HWIO_DTR_EVT_UNUSED3_ADDR A:0x657a008c
y.create.l HWIO_DTR_EVT_UNUSED4_ADDR A:0x657a0090
y.create.l HWIO_DTR_CLK_DIV_CFG_ADDR A:0x657a0094
y.create.l HWIO_DTR_TXFE0_EN_ADDR A:0x657a0098
y.create.l HWIO_DTR_TXFE1_EN_ADDR A:0x657a009c
y.create.l HWIO_DTR_RXFE_EN_ADDR A:0x657a00a0
y.create.l HWIO_DTR_DAC0_EN_ADDR A:0x657a00a4
y.create.l HWIO_DTR_DAC1_EN_ADDR A:0x657a00a8
y.create.l HWIO_DTR_CARR_AGGREGATION_MODE_ADDR A:0x657a00ac
y.create.l HWIO_DTR_TXFE0_STATE_RESET_ADDR A:0x657a00b0
y.create.l HWIO_DTR_TXFE1_STATE_RESET_ADDR A:0x657a00b4
y.create.l HWIO_DTR_TXFE0_BYPASS_ADDR A:0x657a00b8
y.create.l HWIO_DTR_TXFE1_BYPASS_ADDR A:0x657a00bc
y.create.l HWIO_DTR_TXFE0_STMR_SYNC_TRIG_ADDR A:0x657a00c0
y.create.l HWIO_DTR_TXFE1_STMR_SYNC_TRIG_ADDR A:0x657a00c4
y.create.l HWIO_DTR_RXFE_XO_TRIGGER_RXCH0_ADDR A:0x657a00c8
y.create.l HWIO_DTR_RXFE_XO_TRIGGER_RXCH1_ADDR A:0x657a00cc
y.create.l HWIO_DTR_RXFE_XO_TRIGGER_RXCH2_ADDR A:0x657a00d0
y.create.l HWIO_DTR_RXFE_XO_TRIGGER_RXCH3_ADDR A:0x657a00d4
y.create.l HWIO_DTR_RXFE_XO_TRIGGER_RXCH4_ADDR A:0x657a00d8
y.create.l HWIO_DTR_RXFE_XO_TRIGGER_RXCH5_ADDR A:0x657a00dc
y.create.l HWIO_DTR_RXFE_XO_TRIGGER_RXCH6_ADDR A:0x657a00e0
y.create.l HWIO_DTR_TXFE0_SAMPLE_COUNT_LOAD_NSAMPLE_ADDR A:0x657a000c
y.create.l HWIO_DTR_TXFE0_SAMPLE_COUNT_LOAD_UPDATE_INDEX_ADDR A:0x657a0010
y.create.l HWIO_DTR_TXFE0_SAMPLE_COUNT_LOAD_LOG_START_ADDR A:0x657a0014
y.create.l HWIO_DTR_TXFE0_SAMPLE_COUNT_LOAD_LOG_STOP_ADDR A:0x657a0018
y.create.l HWIO_DTR_TXFE0_SAMPLE_COUNT_LOAD_UPDATE_ENABLE_ADDR A:0x657a001c
y.create.l HWIO_DTR_TXFE0_SAMPLE_COUNT_LOAD_SAMPLE_COUNT_UPDATE_STATUS_ADDR A:0x657a0020
y.create.l HWIO_DTR_TXFE0_DONE_COUNT_RDB_DONE_SAMPLE_COUNT_ADDR A:0x657a0034
y.create.l HWIO_DTR_TXFE0_DONE_COUNT_RDB_DONE_STMR_COUNT_ADDR A:0x657a0038
y.create.l HWIO_DTR_TXFE1_SAMPLE_COUNT_LOAD_NSAMPLE_ADDR A:0x657a004c
y.create.l HWIO_DTR_TXFE1_SAMPLE_COUNT_LOAD_UPDATE_INDEX_ADDR A:0x657a0050
y.create.l HWIO_DTR_TXFE1_SAMPLE_COUNT_LOAD_LOG_START_ADDR A:0x657a0054
y.create.l HWIO_DTR_TXFE1_SAMPLE_COUNT_LOAD_LOG_STOP_ADDR A:0x657a0058
y.create.l HWIO_DTR_TXFE1_SAMPLE_COUNT_LOAD_UPDATE_ENABLE_ADDR A:0x657a005c
y.create.l HWIO_DTR_TXFE1_SAMPLE_COUNT_LOAD_SAMPLE_COUNT_UPDATE_STATUS_ADDR A:0x657a0060
y.create.l HWIO_DTR_TXFE1_DONE_COUNT_RDB_DONE_SAMPLE_COUNT_ADDR A:0x657a0070
y.create.l HWIO_DTR_TXFE1_DONE_COUNT_RDB_DONE_STMR_COUNT_ADDR A:0x657a0074
y.create.l HWIO_DTR_TXFE_SP_CFG_CHAIN0_ADDR A:0x657b8000
y.create.l HWIO_DTR_TXFE_SP_REFLOG_CHAIN0_ADDR A:0x657b8004
y.create.l HWIO_DTR_TXFE_SP_PPDSM_CFG_CHAIN0_ADDR A:0x657b8008
y.create.l HWIO_DTR_TXFE_SP_FMTC_CHAIN0_ADDR A:0x657b800c
y.create.l HWIO_DTR_TXET_SP_FMTC_CHAIN0_ADDR A:0x657b8010
y.create.l HWIO_DTR_TXFE_SP_QPT_CFG_CHAIN0_ADDR A:0x657b8014
y.create.l HWIO_DTR_TXFE_SP_DM2_FINE_TAU_CHAIN0_ADDR A:0x657b8018
y.create.l HWIO_DTR_TXFE_SP_DM3_FRAC_TAU_CHAIN0_ADDR A:0x657b801c
y.create.l HWIO_DTR_TXFE_SP_UDM1_CFG_CHAIN0_ADDR A:0x657b8020
y.create.l HWIO_DTR_TXFE_SP_QPTSP_DM4_CFG_CHAIN0_ADDR A:0x657b8024
y.create.l HWIO_DTR_TXFE_SP_LUTS_RDBADDR_CHAIN0_ADDR A:0x657b8028
y.create.l HWIO_DTR_TXFE_SP_LUTS_RDBDATA_CHAIN0_ADDR A:0x657b802c
y.create.l HWIO_DTR_TXFE_DPRDB_ENVRAMP_RAMP_ARM_CHAIN0_ADDR A:0x657b8030
y.create.l HWIO_DTR_TXFE_DPRDB_ENVRAMP_RAMP_SLOT_A_CFG_CHAIN0_ADDR A:0x657b8034
y.create.l HWIO_DTR_TXFE_DPRDB_ENVRAMP_RAMP_SLOT_B_CFG_CHAIN0_ADDR A:0x657b8038
y.create.l HWIO_DTR_TXFE_DPRDB_ENVRAMP_RAMP_GAP_CHAIN0_ADDR A:0x657b803c
y.create.l HWIO_DTR_TXFE_DPRDB_ENV_RAMP_SCALE_VAL_CHAIN0_ADDR A:0x657b8040
y.create.l HWIO_DTR_TXFE_DPRDB_PPDS_GAIN_CHAIN0_ADDR A:0x657b8044
y.create.l HWIO_DTR_TXFE_DPRDB_GSM_RAMP_LUT_CFG_CHAIN0_ADDR A:0x657b8048
y.create.l HWIO_DTR_TXFE_DPRDB_PHASE_OVR_VAL_CHAIN0_ADDR A:0x657b804c
y.create.l HWIO_DTR_TXFE_DPRDB_DPRDB_ENV_OVR_VAL_CHAIN0_ADDR A:0x657b8050
y.create.l HWIO_DTR_TXFE_DPRDB_ET_ENV_OVR_VAL_CHAIN0_ADDR A:0x657b8054
y.create.l HWIO_DTR_TXFE_DPRDB_ROTATOR_CFG_CHAIN0_ADDR A:0x657b8058
y.create.l HWIO_DTR_TXFE_DPRDB_ROTATOR_PHASE_INC_CHAIN0_ADDR A:0x657b805c
y.create.l HWIO_DTR_TXFE_DPRDB_ROTATOR_PHASE_INIT_CHAIN0_ADDR A:0x657b8060
y.create.l HWIO_DTR_TXFE_DPRDB_ROTATOR_PHASE_SHIFT_CHAIN0_ADDR A:0x657b8064
y.create.l HWIO_DTR_TXFE_DPRDB_CARAGG_CFG_CHAIN0_ADDR A:0x657b8068
y.create.l HWIO_DTR_TXFE_DPRDB_DPRDBSEL_CFG0_CHAIN0_ADDR A:0x657b806c
y.create.l HWIO_DTR_TXFE_DPRDB_DPRDBSEL_CFG1_CHAIN0_ADDR A:0x657b8070
y.create.l HWIO_DTR_TXFE_DPRDB_EPT_AMAM_LUT_CFG_CHAIN0_ADDR A:0x657b8074
y.create.l HWIO_DTR_TXFE_DPRDB_EPT_AMPM_LUT_CFG_CHAIN0_ADDR A:0x657b8078
y.create.l HWIO_DTR_TXFE_DPRDB_ET_AMAM_LUT_CFG_CHAIN0_ADDR A:0x657b807c
y.create.l HWIO_DTR_TXFE_DPRDB_ET_AMPM_LUT_CFG_CHAIN0_ADDR A:0x657b8080
y.create.l HWIO_DTR_TXFE_DPRDB_ETDT_LUT_CFG_CHAIN0_ADDR A:0x657b8084
y.create.l HWIO_DTR_TXFE_DPRDB_SPINV_CHAIN0_ADDR A:0x657b8088
y.create.l HWIO_DTR_TXFE_DPRDB_UDM1_CFG_CHAIN0_ADDR A:0x657b808c
y.create.l HWIO_DTR_TXFE_DPRDB_QPT_CFG_CHAIN0_ADDR A:0x657b8090
y.create.l HWIO_DTR_TXFE_DPRDB_QPT_AMAM_LUT_CFG_CHAIN0_ADDR A:0x657b8094
y.create.l HWIO_DTR_TXFE_DPRDB_QPT_AMPM_0_LUT_CFG_CHAIN0_ADDR A:0x657b8098
y.create.l HWIO_DTR_TXFE_DPRDB_QPT_PREDICT_CHAIN0_ADDR A:0x657b809c
y.create.l HWIO_DTR_TXFE_DPRDB_QPT_PREDICT_RLC_METRIC_CHAIN0_ADDR A:0x657b80a0
y.create.l HWIO_DTR_TXFE_DPRDB_QPT_PREDICT_UPPER_LIMIT_CHAIN0_ADDR A:0x657b80a4
y.create.l HWIO_DTR_TXFE_DPRDB_QPT_PREDICT_AMPM_VESTIMATE_CHAIN0_ADDR A:0x657b80a8
y.create.l HWIO_DTR_TXFE_DPRDB_QPT_BLUT_LUT_CFG_CHAIN0_ADDR A:0x657b80ac
y.create.l HWIO_DTR_TXFE_DPRDB_QPT_AMAM_PRELUT_LUT_CFG_CHAIN0_ADDR A:0x657b80b0
y.create.l HWIO_DTR_TXFE_DPRDB_QPT_AMAM_POSTLUT_LUT_CFG_CHAIN0_ADDR A:0x657b80b4
y.create.l HWIO_DTR_TXFE_DPRDB_QPT_AMPM_1_LUT_CFG_CHAIN0_ADDR A:0x657b80b8
y.create.l HWIO_DTR_TXFE_DPRDB_QPT_AMPM_2_LUT_CFG_CHAIN0_ADDR A:0x657b80bc
y.create.l HWIO_DTR_TXFE_DPRDB_QPT_AMPM_3_LUT_CFG_CHAIN0_ADDR A:0x657b80c0
y.create.l HWIO_DTR_TXFE_DPRDB_GH_LUT_CFG_CHAIN0_ADDR A:0x657b80c4
y.create.l HWIO_DTR_TXFE_DPRDB_QPT_OVERRIDE_CHAIN0_ADDR A:0x657b80c8
y.create.l HWIO_DTR_TXFE_DPRDB_IREF_UPDT_CFG_CHAIN0_ADDR A:0x657b80cc
y.create.l HWIO_DTR_TXRFI_DPRDB_CFG_CHAIN0_ADDR A:0x657b80d0
y.create.l HWIO_DTR_TXRFI_DPRDB_GAIN_CHAIN0_ADDR A:0x657b80d4
y.create.l HWIO_DTR_TXRFI_DPRDB_GAIN2_CHAIN0_ADDR A:0x657b80d8
y.create.l HWIO_DTR_TXRFI_DPRDB_IQMC_CHAIN0_ADDR A:0x657b80dc
y.create.l HWIO_DTR_TXRFI_DPRDB_PEQ1_CHAIN0_ADDR A:0x657b80e0
y.create.l HWIO_DTR_TXRFI_DPRDB_PEQ1_SORU_CHAIN0_ADDR A:0x657b80e4
y.create.l HWIO_DTR_TXRFI_DPRDB_PEQ2_CHAIN0_ADDR A:0x657b80e8
y.create.l HWIO_DTR_TXRFI_DPRDB_DCOC_CHAIN0_ADDR A:0x657b80ec
y.create.l HWIO_DTR_TXRFI_DPRDB_SAWEQ_COEFF0_CHAIN0_ADDR A:0x657b80f0
y.create.l HWIO_DTR_TXRFI_DPRDB_SAWEQ_COEFF1_CHAIN0_ADDR A:0x657b80f4
y.create.l HWIO_DTR_TXRFI_DPRDB_SAWEQ_COEFF2_CHAIN0_ADDR A:0x657b80f8
y.create.l HWIO_DTR_TXRFI_DPRDB_SAWEQ_COEFF3_CHAIN0_ADDR A:0x657b80fc
y.create.l HWIO_DTR_TXRFI_DPRDB_SAWEQ_COEFF4_CHAIN0_ADDR A:0x657b8100
y.create.l HWIO_DTR_TXRFI_DPRDB_SAWEQ_COEFF5_CHAIN0_ADDR A:0x657b8104
y.create.l HWIO_DTR_TXRFI_DPRDB_SAWEQ_COEFF6_CHAIN0_ADDR A:0x657b8108
y.create.l HWIO_DTR_TXRFI_DPRDB_SAWEQ_COEFF7_CHAIN0_ADDR A:0x657b810c
y.create.l HWIO_DTR_TXET_DPRDB_CFG_CHAIN0_ADDR A:0x657b8110
y.create.l HWIO_DTR_TXET_DPRDB_GAIN_CHAIN0_ADDR A:0x657b8114
y.create.l HWIO_DTR_TXET_DPRDB_PEQ1_CHAIN0_ADDR A:0x657b8118
y.create.l HWIO_DTR_TXET_DPRDB_PEQ1_SORU_CHAIN0_ADDR A:0x657b811c
y.create.l HWIO_DTR_TXET_DPRDB_PEQ2_CHAIN0_ADDR A:0x657b8120
y.create.l HWIO_DTR_TXET_DPRDB_DCOC_CHAIN0_ADDR A:0x657b8124
y.create.l HWIO_DTR_TXET_DPRDB_DM2_FINE_TAU_CHAIN0_ADDR A:0x657b8128
y.create.l HWIO_DTR_TXET_DPRDB_DM3_FRAC_TAU_CHAIN0_ADDR A:0x657b812c
y.create.l HWIO_DTR_TXFE_SP_CFG_CHAIN1_ADDR A:0x657c0000
y.create.l HWIO_DTR_TXFE_SP_REFLOG_CHAIN1_ADDR A:0x657c0004
y.create.l HWIO_DTR_TXFE_SP_PPDSM_CFG_CHAIN1_ADDR A:0x657c0008
y.create.l HWIO_DTR_TXFE_SP_FMTC_CHAIN1_ADDR A:0x657c000c
y.create.l HWIO_DTR_TXET_SP_FMTC_CHAIN1_ADDR A:0x657c0010
y.create.l HWIO_DTR_TXFE_SP_QPT_CFG_CHAIN1_ADDR A:0x657c0014
y.create.l HWIO_DTR_TXFE_SP_DM2_FINE_TAU_CHAIN1_ADDR A:0x657c0018
y.create.l HWIO_DTR_TXFE_SP_DM3_FRAC_TAU_CHAIN1_ADDR A:0x657c001c
y.create.l HWIO_DTR_TXFE_SP_UDM1_CFG_CHAIN1_ADDR A:0x657c0020
y.create.l HWIO_DTR_TXFE_SP_QPTSP_DM4_CFG_CHAIN1_ADDR A:0x657c0024
y.create.l HWIO_DTR_TXFE_SP_LUTS_RDBADDR_CHAIN1_ADDR A:0x657c0028
y.create.l HWIO_DTR_TXFE_SP_LUTS_RDBDATA_CHAIN1_ADDR A:0x657c002c
y.create.l HWIO_DTR_TXFE_DPRDB_ENVRAMP_RAMP_ARM_CHAIN1_ADDR A:0x657c0030
y.create.l HWIO_DTR_TXFE_DPRDB_ENVRAMP_RAMP_SLOT_A_CFG_CHAIN1_ADDR A:0x657c0034
y.create.l HWIO_DTR_TXFE_DPRDB_ENVRAMP_RAMP_SLOT_B_CFG_CHAIN1_ADDR A:0x657c0038
y.create.l HWIO_DTR_TXFE_DPRDB_ENVRAMP_RAMP_GAP_CHAIN1_ADDR A:0x657c003c
y.create.l HWIO_DTR_TXFE_DPRDB_ENV_RAMP_SCALE_VAL_CHAIN1_ADDR A:0x657c0040
y.create.l HWIO_DTR_TXFE_DPRDB_PPDS_GAIN_CHAIN1_ADDR A:0x657c0044
y.create.l HWIO_DTR_TXFE_DPRDB_GSM_RAMP_LUT_CFG_CHAIN1_ADDR A:0x657c0048
y.create.l HWIO_DTR_TXFE_DPRDB_PHASE_OVR_VAL_CHAIN1_ADDR A:0x657c004c
y.create.l HWIO_DTR_TXFE_DPRDB_DPRDB_ENV_OVR_VAL_CHAIN1_ADDR A:0x657c0050
y.create.l HWIO_DTR_TXFE_DPRDB_ET_ENV_OVR_VAL_CHAIN1_ADDR A:0x657c0054
y.create.l HWIO_DTR_TXFE_DPRDB_ROTATOR_CFG_CHAIN1_ADDR A:0x657c0058
y.create.l HWIO_DTR_TXFE_DPRDB_ROTATOR_PHASE_INC_CHAIN1_ADDR A:0x657c005c
y.create.l HWIO_DTR_TXFE_DPRDB_ROTATOR_PHASE_INIT_CHAIN1_ADDR A:0x657c0060
y.create.l HWIO_DTR_TXFE_DPRDB_ROTATOR_PHASE_SHIFT_CHAIN1_ADDR A:0x657c0064
y.create.l HWIO_DTR_TXFE_DPRDB_CARAGG_CFG_CHAIN1_ADDR A:0x657c0068
y.create.l HWIO_DTR_TXFE_DPRDB_DPRDBSEL_CFG0_CHAIN1_ADDR A:0x657c006c
y.create.l HWIO_DTR_TXFE_DPRDB_DPRDBSEL_CFG1_CHAIN1_ADDR A:0x657c0070
y.create.l HWIO_DTR_TXFE_DPRDB_EPT_AMAM_LUT_CFG_CHAIN1_ADDR A:0x657c0074
y.create.l HWIO_DTR_TXFE_DPRDB_EPT_AMPM_LUT_CFG_CHAIN1_ADDR A:0x657c0078
y.create.l HWIO_DTR_TXFE_DPRDB_ET_AMAM_LUT_CFG_CHAIN1_ADDR A:0x657c007c
y.create.l HWIO_DTR_TXFE_DPRDB_ET_AMPM_LUT_CFG_CHAIN1_ADDR A:0x657c0080
y.create.l HWIO_DTR_TXFE_DPRDB_ETDT_LUT_CFG_CHAIN1_ADDR A:0x657c0084
y.create.l HWIO_DTR_TXFE_DPRDB_SPINV_CHAIN1_ADDR A:0x657c0088
y.create.l HWIO_DTR_TXFE_DPRDB_UDM1_CFG_CHAIN1_ADDR A:0x657c008c
y.create.l HWIO_DTR_TXFE_DPRDB_QPT_CFG_CHAIN1_ADDR A:0x657c0090
y.create.l HWIO_DTR_TXFE_DPRDB_QPT_AMAM_LUT_CFG_CHAIN1_ADDR A:0x657c0094
y.create.l HWIO_DTR_TXFE_DPRDB_QPT_AMPM_0_LUT_CFG_CHAIN1_ADDR A:0x657c0098
y.create.l HWIO_DTR_TXFE_DPRDB_QPT_PREDICT_CHAIN1_ADDR A:0x657c009c
y.create.l HWIO_DTR_TXFE_DPRDB_QPT_PREDICT_RLC_METRIC_CHAIN1_ADDR A:0x657c00a0
y.create.l HWIO_DTR_TXFE_DPRDB_QPT_PREDICT_UPPER_LIMIT_CHAIN1_ADDR A:0x657c00a4
y.create.l HWIO_DTR_TXFE_DPRDB_QPT_PREDICT_AMPM_VESTIMATE_CHAIN1_ADDR A:0x657c00a8
y.create.l HWIO_DTR_TXFE_DPRDB_QPT_BLUT_LUT_CFG_CHAIN1_ADDR A:0x657c00ac
y.create.l HWIO_DTR_TXFE_DPRDB_QPT_AMAM_PRELUT_LUT_CFG_CHAIN1_ADDR A:0x657c00b0
y.create.l HWIO_DTR_TXFE_DPRDB_QPT_AMAM_POSTLUT_LUT_CFG_CHAIN1_ADDR A:0x657c00b4
y.create.l HWIO_DTR_TXFE_DPRDB_QPT_AMPM_1_LUT_CFG_CHAIN1_ADDR A:0x657c00b8
y.create.l HWIO_DTR_TXFE_DPRDB_QPT_AMPM_2_LUT_CFG_CHAIN1_ADDR A:0x657c00bc
y.create.l HWIO_DTR_TXFE_DPRDB_QPT_AMPM_3_LUT_CFG_CHAIN1_ADDR A:0x657c00c0
y.create.l HWIO_DTR_TXFE_DPRDB_GH_LUT_CFG_CHAIN1_ADDR A:0x657c00c4
y.create.l HWIO_DTR_TXFE_DPRDB_QPT_OVERRIDE_CHAIN1_ADDR A:0x657c00c8
y.create.l HWIO_DTR_TXFE_DPRDB_IREF_UPDT_CFG_CHAIN1_ADDR A:0x657c00cc
y.create.l HWIO_DTR_TXRFI_DPRDB_CFG_CHAIN1_ADDR A:0x657c00d0
y.create.l HWIO_DTR_TXRFI_DPRDB_GAIN_CHAIN1_ADDR A:0x657c00d4
y.create.l HWIO_DTR_TXRFI_DPRDB_GAIN2_CHAIN1_ADDR A:0x657c00d8
y.create.l HWIO_DTR_TXRFI_DPRDB_IQMC_CHAIN1_ADDR A:0x657c00dc
y.create.l HWIO_DTR_TXRFI_DPRDB_PEQ1_CHAIN1_ADDR A:0x657c00e0
y.create.l HWIO_DTR_TXRFI_DPRDB_PEQ1_SORU_CHAIN1_ADDR A:0x657c00e4
y.create.l HWIO_DTR_TXRFI_DPRDB_PEQ2_CHAIN1_ADDR A:0x657c00e8
y.create.l HWIO_DTR_TXRFI_DPRDB_DCOC_CHAIN1_ADDR A:0x657c00ec
y.create.l HWIO_DTR_TXRFI_DPRDB_SAWEQ_COEFF0_CHAIN1_ADDR A:0x657c00f0
y.create.l HWIO_DTR_TXRFI_DPRDB_SAWEQ_COEFF1_CHAIN1_ADDR A:0x657c00f4
y.create.l HWIO_DTR_TXRFI_DPRDB_SAWEQ_COEFF2_CHAIN1_ADDR A:0x657c00f8
y.create.l HWIO_DTR_TXRFI_DPRDB_SAWEQ_COEFF3_CHAIN1_ADDR A:0x657c00fc
y.create.l HWIO_DTR_TXRFI_DPRDB_SAWEQ_COEFF4_CHAIN1_ADDR A:0x657c0100
y.create.l HWIO_DTR_TXRFI_DPRDB_SAWEQ_COEFF5_CHAIN1_ADDR A:0x657c0104
y.create.l HWIO_DTR_TXRFI_DPRDB_SAWEQ_COEFF6_CHAIN1_ADDR A:0x657c0108
y.create.l HWIO_DTR_TXRFI_DPRDB_SAWEQ_COEFF7_CHAIN1_ADDR A:0x657c010c
y.create.l HWIO_DTR_TXET_DPRDB_CFG_CHAIN1_ADDR A:0x657c0110
y.create.l HWIO_DTR_TXET_DPRDB_GAIN_CHAIN1_ADDR A:0x657c0114
y.create.l HWIO_DTR_TXET_DPRDB_PEQ1_CHAIN1_ADDR A:0x657c0118
y.create.l HWIO_DTR_TXET_DPRDB_PEQ1_SORU_CHAIN1_ADDR A:0x657c011c
y.create.l HWIO_DTR_TXET_DPRDB_PEQ2_CHAIN1_ADDR A:0x657c0120
y.create.l HWIO_DTR_TXET_DPRDB_DCOC_CHAIN1_ADDR A:0x657c0124
y.create.l HWIO_DTR_TXET_DPRDB_DM2_FINE_TAU_CHAIN1_ADDR A:0x657c0128
y.create.l HWIO_DTR_TXET_DPRDB_DM3_FRAC_TAU_CHAIN1_ADDR A:0x657c012c
y.create.l HWIO_DTR_BRDG_RXFE_WRTR0_CFG0_ADDR A:0x657d0050
y.create.l HWIO_DTR_BRDG_RXFE_WRTR1_CFG0_ADDR A:0x657d0058
y.create.l HWIO_DTR_BRDG_RXFE_WRTR2_CFG0_ADDR A:0x657d0060
y.create.l HWIO_DTR_BRDG_RXFE_WRTR3_CFG0_ADDR A:0x657d0068
y.create.l HWIO_DTR_BRDG_RXFE_WRTR4_CFG0_ADDR A:0x657d0070
y.create.l HWIO_DTR_BRDG_RXFE_WRTR5_CFG0_ADDR A:0x657d0078
y.create.l HWIO_DTR_BRDG_RXFE_WRTR6_CFG0_ADDR A:0x657d0080
y.create.l HWIO_DTR_BRDG_RXFE_WRTR7_CFG0_ADDR A:0x657d0088
y.create.l HWIO_DTR_BRDG_RXFE_WRTR8_CFG0_ADDR A:0x657d0090
y.create.l HWIO_DTR_BRDG_RXFE_WRTR9_CFG0_ADDR A:0x657d0098
y.create.l HWIO_DTR_BRDG_RXFE_WRTR0_CFG1_ADDR A:0x657d0054
y.create.l HWIO_DTR_BRDG_RXFE_WRTR1_CFG1_ADDR A:0x657d005c
y.create.l HWIO_DTR_BRDG_RXFE_WRTR2_CFG1_ADDR A:0x657d0064
y.create.l HWIO_DTR_BRDG_RXFE_WRTR3_CFG1_ADDR A:0x657d006c
y.create.l HWIO_DTR_BRDG_RXFE_WRTR4_CFG1_ADDR A:0x657d0074
y.create.l HWIO_DTR_BRDG_RXFE_WRTR5_CFG1_ADDR A:0x657d007c
y.create.l HWIO_DTR_BRDG_RXFE_WRTR6_CFG1_ADDR A:0x657d0084
y.create.l HWIO_DTR_BRDG_RXFE_WRTR7_CFG1_ADDR A:0x657d008c
y.create.l HWIO_DTR_BRDG_RXFE_WRTR8_CFG1_ADDR A:0x657d0094
y.create.l HWIO_DTR_BRDG_RXFE_WRTR9_CFG1_ADDR A:0x657d009c
y.create.l HWIO_DTR_BRDG_RXFE_WRTR_XFER_CTL_ADDR A:0x657d0040
y.create.l HWIO_DTR_BRDG_RXFE_WRTR_CTL_ADDR A:0x657d0044
y.create.l HWIO_DTR_BRDG_RXFE_WRTR_STATUS_ADDR A:0x657d0048
y.create.l HWIO_DTR_BRDG_RXFE_WRTR_CLEAR_ADDR A:0x657d004c
y.create.l HWIO_DTR_BRDG_FBRX_WRTR_CFG0_ADDR A:0x657d0100
y.create.l HWIO_DTR_BRDG_FBRX_WRTR_CFG1_ADDR A:0x657d0104
y.create.l HWIO_DTR_BRDG_FBRX_WRTR_XFER_CTL_ADDR A:0x657d0108
y.create.l HWIO_DTR_BRDG_FBRX_WRTR_CTL_ADDR A:0x657d010c
y.create.l HWIO_DTR_BRDG_FBRX_WRTR_STATUS_ADDR A:0x657d0110
y.create.l HWIO_DTR_BRDG_FBRX_WRTR_CLEAR_ADDR A:0x657d0114
y.create.l HWIO_DTR_BRDG_TXFE_RDR0_CFG0_ADDR A:0x657d0200
y.create.l HWIO_DTR_BRDG_TXFE_RDR1_CFG0_ADDR A:0x657d0210
y.create.l HWIO_DTR_BRDG_TXFE_RDR0_CFG1_ADDR A:0x657d0204
y.create.l HWIO_DTR_BRDG_TXFE_RDR1_CFG1_ADDR A:0x657d0214
y.create.l HWIO_DTR_BRDG_TXFE_RDR0_XFER_LEN_ADDR A:0x657d0208
y.create.l HWIO_DTR_BRDG_TXFE_RDR1_XFER_LEN_ADDR A:0x657d0218
y.create.l HWIO_DTR_BRDG_TXFE_RDR0_VADDR_ADDR A:0x657d020c
y.create.l HWIO_DTR_BRDG_TXFE_RDR1_VADDR_ADDR A:0x657d021c
y.create.l HWIO_DTR_BRDG_TXFE_RDR_XFER_CTL_ADDR A:0x657d0220
y.create.l HWIO_DTR_BRDG_TXFE_RDR_CTL_ADDR A:0x657d0224
y.create.l HWIO_DTR_BRDG_TXFE_RDR_STATUS_ADDR A:0x657d0228
y.create.l HWIO_DTR_BRDG_TXFE_RDR_CLEAR_ADDR A:0x657d022c
y.create.l HWIO_DTR_BRDG_REFLOG_WRTR_CFG0_ADDR A:0x657d0300
y.create.l HWIO_DTR_BRDG_REFLOG_WRTR_CFG1_ADDR A:0x657d0304
y.create.l HWIO_DTR_BRDG_REFLOG_WRTR_XFER_LEN_ADDR A:0x657d0308
y.create.l HWIO_DTR_BRDG_REFLOG_WRTR_VADDR_ADDR A:0x657d030c
y.create.l HWIO_DTR_BRDG_REFLOG_WRTR_XFER_CTL_ADDR A:0x657d0310
y.create.l HWIO_DTR_BRDG_REFLOG_WRTR_CTL_ADDR A:0x657d0314
y.create.l HWIO_DTR_BRDG_REFLOG_WRTR_STATUS_ADDR A:0x657d0318
y.create.l HWIO_DTR_BRDG_REFLOG_WRTR_CLEAR_ADDR A:0x657d031c
y.create.l HWIO_DTR_BRDG_TXCONFIG_CH0_CFG0_ADDR A:0x657d0400
y.create.l HWIO_DTR_BRDG_TXCONFIG_CH1_CFG0_ADDR A:0x657d0408
y.create.l HWIO_DTR_BRDG_TXCONFIG_CH2_CFG0_ADDR A:0x657d0410
y.create.l HWIO_DTR_BRDG_TXCONFIG_CH3_CFG0_ADDR A:0x657d0418
y.create.l HWIO_DTR_BRDG_TXCONFIG_CH4_CFG0_ADDR A:0x657d0420
y.create.l HWIO_DTR_BRDG_TXCONFIG_CH5_CFG0_ADDR A:0x657d0428
y.create.l HWIO_DTR_BRDG_TXCONFIG_CH6_CFG0_ADDR A:0x657d0430
y.create.l HWIO_DTR_BRDG_TXCONFIG_CH7_CFG0_ADDR A:0x657d0438
y.create.l HWIO_DTR_BRDG_TXCONFIG_CH0_CFG1_ADDR A:0x657d0404
y.create.l HWIO_DTR_BRDG_TXCONFIG_CH1_CFG1_ADDR A:0x657d040c
y.create.l HWIO_DTR_BRDG_TXCONFIG_CH2_CFG1_ADDR A:0x657d0414
y.create.l HWIO_DTR_BRDG_TXCONFIG_CH3_CFG1_ADDR A:0x657d041c
y.create.l HWIO_DTR_BRDG_TXCONFIG_CH4_CFG1_ADDR A:0x657d0424
y.create.l HWIO_DTR_BRDG_TXCONFIG_CH5_CFG1_ADDR A:0x657d042c
y.create.l HWIO_DTR_BRDG_TXCONFIG_CH6_CFG1_ADDR A:0x657d0434
y.create.l HWIO_DTR_BRDG_TXCONFIG_CH7_CFG1_ADDR A:0x657d043c
y.create.l HWIO_DTR_BRDG_TXCONFIG_VBUF0_CFG0_ADDR A:0x657d0440
y.create.l HWIO_DTR_BRDG_TXCONFIG_VBUF1_CFG0_ADDR A:0x657d0448
y.create.l HWIO_DTR_BRDG_TXCONFIG_VBUF2_CFG0_ADDR A:0x657d0450
y.create.l HWIO_DTR_BRDG_TXCONFIG_VBUF3_CFG0_ADDR A:0x657d0458
y.create.l HWIO_DTR_BRDG_TXCONFIG_VBUF4_CFG0_ADDR A:0x657d0460
y.create.l HWIO_DTR_BRDG_TXCONFIG_VBUF5_CFG0_ADDR A:0x657d0468
y.create.l HWIO_DTR_BRDG_TXCONFIG_VBUF6_CFG0_ADDR A:0x657d0470
y.create.l HWIO_DTR_BRDG_TXCONFIG_VBUF7_CFG0_ADDR A:0x657d0478
y.create.l HWIO_DTR_BRDG_TXCONFIG_VBUF0_CFG1_ADDR A:0x657d0444
y.create.l HWIO_DTR_BRDG_TXCONFIG_VBUF1_CFG1_ADDR A:0x657d044c
y.create.l HWIO_DTR_BRDG_TXCONFIG_VBUF2_CFG1_ADDR A:0x657d0454
y.create.l HWIO_DTR_BRDG_TXCONFIG_VBUF3_CFG1_ADDR A:0x657d045c
y.create.l HWIO_DTR_BRDG_TXCONFIG_VBUF4_CFG1_ADDR A:0x657d0464
y.create.l HWIO_DTR_BRDG_TXCONFIG_VBUF5_CFG1_ADDR A:0x657d046c
y.create.l HWIO_DTR_BRDG_TXCONFIG_VBUF6_CFG1_ADDR A:0x657d0474
y.create.l HWIO_DTR_BRDG_TXCONFIG_VBUF7_CFG1_ADDR A:0x657d047c
y.create.l HWIO_DTR_BRDG_TXCONFIG_CH_ENABLE_ADDR A:0x657d0480
y.create.l HWIO_DTR_BRDG_TXCONFIG_CH_DISABLE_ADDR A:0x657d0484
y.create.l HWIO_DTR_BRDG_TXCONFIG_CH_STATUS_ADDR A:0x657d0488
y.create.l HWIO_DTR_BRDG_TXCONFIG_RDR_CLEAR_ADDR A:0x657d048c
y.create.l HWIO_DAC_CALIB_CFG_0_ADDR A:0x657d8000
y.create.l HWIO_DAC_IREF_UPDATE_0_ADDR A:0x657d8008
y.create.l HWIO_DAC_RT_FUSE_CODE_0_ADDR A:0x657d8010
y.create.l HWIO_TXDAC_CONFIG0_0_ADDR A:0x657d8018
y.create.l HWIO_TXDAC_CONFIG1_0_ADDR A:0x657d8020
y.create.l HWIO_TXDAC_CONFIG2_0_ADDR A:0x657d8028
y.create.l HWIO_TXDAC_CONFIG3_0_ADDR A:0x657d8030
y.create.l HWIO_ETDAC_CONFIG0_0_ADDR A:0x657d8038
y.create.l HWIO_ETDAC_CONFIG1_0_ADDR A:0x657d8040
y.create.l HWIO_ETDAC_CONFIG2_0_ADDR A:0x657d8048
y.create.l HWIO_ETDAC_CONFIG3_0_ADDR A:0x657d8050
y.create.l HWIO_DAC_CALIB_STATUS_0_ADDR A:0x657d8060
y.create.l HWIO_DAC_ATEST_MUX_SEL_0_ADDR A:0x657d8068
y.create.l HWIO_TXDAC_DEBUG_MODE_0_ADDR A:0x657d8070
y.create.l HWIO_ETDAC_DEBUG_MODE_0_ADDR A:0x657d8078
y.create.l HWIO_TXDAC_STATUS0_0_ADDR A:0x657d8080
y.create.l HWIO_TXDAC_STATUS1_0_ADDR A:0x657d8088
y.create.l HWIO_ETDAC_STATUS0_0_ADDR A:0x657d8090
y.create.l HWIO_ETDAC_STATUS1_0_ADDR A:0x657d8098
y.create.l HWIO_DAC_CALIB_CMDS_0_ADDR A:0x657d80a0
y.create.l HWIO_DAC_MANUAL_MEM_DEBUG_0_ADDR A:0x657d80a8
y.create.l HWIO_DAC_SIGGEN_CFG_0_ADDR A:0x657d80b0
y.create.l HWIO_DAC_GPIO_CFG_0_ADDR A:0x657d80b8
y.create.l HWIO_DAC_MANUAL_MEM_RD_0_ADDR A:0x657d80c0
y.create.l HWIO_TXDAC_ING_CFG_0_ADDR A:0x657d80c8
y.create.l HWIO_ETDAC_ING_CFG_0_ADDR A:0x657d80d0
y.create.l HWIO_TXDAC_OUTG_DATA_0_ADDR A:0x657d80d8
y.create.l HWIO_ETDAC_OUTG_DATA_0_ADDR A:0x657d80e0
y.create.l HWIO_TXDAC_PGM_DATA_CFG_0_ADDR A:0x657d80e8
y.create.l HWIO_ETDAC_PGM_DATA_CFG_0_ADDR A:0x657d80f0
y.create.l HWIO_DAC_REGARRAY_START_0_ADDR A:0x657d9000
y.create.l HWIO_DAC_REGARRAY_END_0_ADDR A:0x657d9120
y.create.l HWIO_DAC_CALIB_CFG_1_ADDR A:0x657da000
y.create.l HWIO_DAC_IREF_UPDATE_1_ADDR A:0x657da008
y.create.l HWIO_DAC_RT_FUSE_CODE_1_ADDR A:0x657da010
y.create.l HWIO_TXDAC_CONFIG0_1_ADDR A:0x657da018
y.create.l HWIO_TXDAC_CONFIG1_1_ADDR A:0x657da020
y.create.l HWIO_TXDAC_CONFIG2_1_ADDR A:0x657da028
y.create.l HWIO_TXDAC_CONFIG3_1_ADDR A:0x657da030
y.create.l HWIO_ETDAC_CONFIG0_1_ADDR A:0x657da038
y.create.l HWIO_ETDAC_CONFIG1_1_ADDR A:0x657da040
y.create.l HWIO_ETDAC_CONFIG2_1_ADDR A:0x657da048
y.create.l HWIO_ETDAC_CONFIG3_1_ADDR A:0x657da050
y.create.l HWIO_DAC_CALIB_STATUS_1_ADDR A:0x657da060
y.create.l HWIO_DAC_ATEST_MUX_SEL_1_ADDR A:0x657da068
y.create.l HWIO_TXDAC_DEBUG_MODE_1_ADDR A:0x657da070
y.create.l HWIO_ETDAC_DEBUG_MODE_1_ADDR A:0x657da078
y.create.l HWIO_TXDAC_STATUS0_1_ADDR A:0x657da080
y.create.l HWIO_TXDAC_STATUS1_1_ADDR A:0x657da088
y.create.l HWIO_ETDAC_STATUS0_1_ADDR A:0x657da090
y.create.l HWIO_ETDAC_STATUS1_1_ADDR A:0x657da098
y.create.l HWIO_DAC_CALIB_CMDS_1_ADDR A:0x657da0a0
y.create.l HWIO_DAC_MANUAL_MEM_DEBUG_1_ADDR A:0x657da0a8
y.create.l HWIO_DAC_SIGGEN_CFG_1_ADDR A:0x657da0b0
y.create.l HWIO_DAC_GPIO_CFG_1_ADDR A:0x657da0b8
y.create.l HWIO_DAC_MANUAL_MEM_RD_1_ADDR A:0x657da0c0
y.create.l HWIO_TXDAC_ING_CFG_1_ADDR A:0x657da0c8
y.create.l HWIO_ETDAC_ING_CFG_1_ADDR A:0x657da0d0
y.create.l HWIO_TXDAC_OUTG_DATA_1_ADDR A:0x657da0d8
y.create.l HWIO_ETDAC_OUTG_DATA_1_ADDR A:0x657da0e0
y.create.l HWIO_TXDAC_PGM_DATA_CFG_1_ADDR A:0x657da0e8
y.create.l HWIO_ETDAC_PGM_DATA_CFG_1_ADDR A:0x657da0f0
y.create.l HWIO_DAC_REGARRAY_START_1_ADDR A:0x657db000
y.create.l HWIO_DAC_REGARRAY_END_1_ADDR A:0x657db120
y.create.l HWIO_MNOC_AXI_BR_CLST0_BASE_MIN_ADDR A:0x65800000
y.create.l HWIO_MNOC_AXI_BR_CLST0_BASE_MAX_ADDR A:0x65903ffc
y.create.l HWIO_MNOC_AXI_BR_CLST1_BASE_MIN_ADDR A:0x65a00000
y.create.l HWIO_MNOC_AXI_BR_CLST1_BASE_MAX_ADDR A:0x65b03ffc
y.create.l HWIO_MNOC_AXI_BR_CLST2_BASE_MIN_ADDR A:0x65c00000
y.create.l HWIO_MNOC_AXI_BR_CLST2_BASE_MAX_ADDR A:0x65d03ffc
y.create.l HWIO_MNOC_AXI_BR_CLST3_BASE_MIN_ADDR A:0x65e00000
y.create.l HWIO_MNOC_AXI_BR_CLST3_BASE_MAX_ADDR A:0x65f03ffc
y.create.l HWIO_MPM2_MPM_PMIC_VDD_ON_CFG_1_ADDR A:0x604a0000
y.create.l HWIO_MPM2_MPM_PMIC_VDD_ON_CFG_2_ADDR A:0x604a0004
y.create.l HWIO_MPM2_MPM_PMIC_VDD_ON_CFG_3_ADDR A:0x604a0008
y.create.l HWIO_MPM2_MPM_PMIC_VDD_ON_CFG_4_ADDR A:0x604a000c
y.create.l HWIO_MPM2_MPM_PMIC_VDD_ON_CFG_5_ADDR A:0x604a0010
y.create.l HWIO_MPM2_MPM_PMIC_VDD_ON_CFG_6_ADDR A:0x604a0014
y.create.l HWIO_MPM2_MPM_PMIC_VDD_ON_CFG_7_ADDR A:0x604a0018
y.create.l HWIO_MPM2_MPM_PMIC_VDD_ON_CFG_8_ADDR A:0x604a001c
y.create.l HWIO_MPM2_MPM_PMIC_VDD_ON_CFG_9_ADDR A:0x604a0020
y.create.l HWIO_MPM2_MPM_PMIC_VDD_ON_CFG_10_ADDR A:0x604a0024
y.create.l HWIO_MPM2_MPM_PMIC_VDD_ON_CFG_11_ADDR A:0x604a0028
y.create.l HWIO_MPM2_MPM_PMIC_VDD_ON_CFG_12_ADDR A:0x604a002c
y.create.l HWIO_MPM2_MPM_PMIC_VDD_OFF_CFG_1_ADDR A:0x604a0030
y.create.l HWIO_MPM2_MPM_PMIC_VDD_OFF_CFG_2_ADDR A:0x604a0034
y.create.l HWIO_MPM2_MPM_PMIC_VDD_OFF_CFG_3_ADDR A:0x604a0038
y.create.l HWIO_MPM2_MPM_PMIC_VDD_OFF_CFG_4_ADDR A:0x604a003c
y.create.l HWIO_MPM2_MPM_PMIC_VDD_OFF_CFG_5_ADDR A:0x604a0040
y.create.l HWIO_MPM2_MPM_PMIC_VDD_OFF_CFG_6_ADDR A:0x604a0044
y.create.l HWIO_MPM2_MPM_PMIC_VDD_OFF_CFG_7_ADDR A:0x604a0048
y.create.l HWIO_MPM2_MPM_PMIC_VDD_OFF_CFG_8_ADDR A:0x604a004c
y.create.l HWIO_MPM2_MPM_PMIC_VDD_OFF_CFG_9_ADDR A:0x604a0050
y.create.l HWIO_MPM2_MPM_PMIC_VDD_OFF_CFG_10_ADDR A:0x604a0054
y.create.l HWIO_MPM2_MPM_PMIC_VDD_OFF_CFG_11_ADDR A:0x604a0058
y.create.l HWIO_MPM2_MPM_PMIC_VDD_OFF_CFG_12_ADDR A:0x604a005c
y.create.l HWIO_MPM2_MPM_SPMI_CMD_CFG_ADDR A:0x604a0060
y.create.l HWIO_MPM2_MPM_SPMI_CDIV_CNTRL_ADDR A:0x604a0064
y.create.l HWIO_MPM2_MPM_CXO_CTRL_ADDR A:0x604a0068
y.create.l HWIO_MPM2_MPM_PXO_OSC_CTRL_ADDR A:0x604a006c
y.create.l HWIO_MPM2_MPM_LOW_POWER_CFG_ADDR A:0x604a0070
y.create.l HWIO_MPM2_MPM_LOW_POWER_STATUS_ADDR A:0x604a0074
y.create.l HWIO_MPM2_MPM_CXO_POWER_RAMPUP_TIME_ADDR A:0x604a0078
y.create.l HWIO_MPM2_MPM_PXO_WARMUP_TIME_ADDR A:0x604a007c
y.create.l HWIO_MPM2_MPM_HARDWARE_RESTORED_ADDR A:0x604a0080
y.create.l HWIO_MPM2_MPM_INT_CLEAR_1_ADDR A:0x604a0084
y.create.l HWIO_MPM2_MPM_INT_CLEAR_2_ADDR A:0x604a0088
y.create.l HWIO_MPM2_MPM_INT_EN_1_ADDR A:0x604a008c
y.create.l HWIO_MPM2_MPM_INT_EN_2_ADDR A:0x604a0090
y.create.l HWIO_MPM2_MPM_INT_POLARITY_1_ADDR A:0x604a0094
y.create.l HWIO_MPM2_MPM_INT_POLARITY_2_ADDR A:0x604a0098
y.create.l HWIO_MPM2_MPM_DETECT_CTL_1_ADDR A:0x604a009c
y.create.l HWIO_MPM2_MPM_DETECT_CTL_2_ADDR A:0x604a00a0
y.create.l HWIO_MPM2_MPM_DETECT_CTL_3_ADDR A:0x604a00a4
y.create.l HWIO_MPM2_MPM_DETECT_CTL_4_ADDR A:0x604a00a8
y.create.l HWIO_MPM2_MPM_INT_STATUS_1_ADDR A:0x604a00ac
y.create.l HWIO_MPM2_MPM_INT_STATUS_2_ADDR A:0x604a00b0
y.create.l HWIO_MPM2_MPM_INT_WKUP_CLK_SEL_1_ADDR A:0x604a00b4
y.create.l HWIO_MPM2_MPM_INT_WKUP_CLK_SEL_2_ADDR A:0x604a00b8
y.create.l HWIO_MPM2_MPM_DEBUG_BUS_EN_ADDR A:0x604a00bc
y.create.l HWIO_MPM2_MPM_PEN_DEBOUNCE_CTL_ADDR A:0x604a00c0
y.create.l HWIO_MPM2_MPM_WARM_BOOT_CFG_ADDR A:0x604a00c4
y.create.l HWIO_MPM2_MPM_REG0_FILE_ADDR A:0x604a00c8
y.create.l HWIO_MPM2_MPM_REG1_FILE_ADDR A:0x604a00cc
y.create.l HWIO_MPM2_MPM_REG2_FILE_ADDR A:0x604a00d0
y.create.l HWIO_MPM2_MPM_REG3_FILE_ADDR A:0x604a00d4
y.create.l HWIO_MPM2_MPM_REG4_FILE_ADDR A:0x604a00d8
y.create.l HWIO_MPM2_MPM_REG5_FILE_ADDR A:0x604a00dc
y.create.l HWIO_MPM2_MPM_REG6_FILE_ADDR A:0x604a00e0
y.create.l HWIO_MPM2_MPM_REG7_FILE_ADDR A:0x604a00e4
y.create.l HWIO_MPM2_MPM_REG8_FILE_ADDR A:0x604a00e8
y.create.l HWIO_MPM2_MPM_CNTR_CLK_CONTROL_ADDR A:0x604a00ec
y.create.l HWIO_MPM2_MPM_CNTR_FRAC_ADDR A:0x604a00f0
y.create.l HWIO_MPM2_MPM_CNTR_INCR_DATA_ADDR A:0x604a00f4
y.create.l HWIO_MPM2_MPM_HW_ID_ADDR A:0x604a00f8
y.create.l HWIO_MPM2_MPM_TS_CNTCV_LO_ADDR A:0x604a0118
y.create.l HWIO_MPM2_MPM_TS_CNTCV_HI_ADDR A:0x604a011c
y.create.l HWIO_MPM2_MPM_TS_CNTR_EN_ADDR A:0x604a0120
y.create.l HWIO_MPM2_MPM_CONTROL_CNTCR_ADDR A:0x604a1000
y.create.l HWIO_MPM2_MPM_CONTROL_CNTSR_ADDR A:0x604a1004
y.create.l HWIO_MPM2_MPM_CONTROL_CNTCV_LO_ADDR A:0x604a1008
y.create.l HWIO_MPM2_MPM_CONTROL_CNTCV_HI_ADDR A:0x604a100c
y.create.l HWIO_MPM2_MPM_CONTROL_CNTFID0_ADDR A:0x604a1020
y.create.l HWIO_MPM2_MPM_CONTROL_ID_ADDR A:0x604a1fd0
y.create.l HWIO_MPM2_MPM_READ_CNTCV_LO_ADDR A:0x604a2000
y.create.l HWIO_MPM2_MPM_READ_CNTCV_HI_ADDR A:0x604a2004
y.create.l HWIO_MPM2_MPM_READ_ID_ADDR A:0x604a2fd0
y.create.l HWIO_MPM2_MPM_SLEEP_TIMETICK_COUNT_VAL_ADDR A:0x604a3000
y.create.l HWIO_MPM2_QTMR_AC_CNTFRQ_ADDR A:0x604a4000
y.create.l HWIO_MPM2_QTMR_AC_CNTSR_ADDR A:0x604a4004
y.create.l HWIO_MPM2_QTMR_AC_CNTTID_ADDR A:0x604a4008
y.create.l HWIO_MPM2_QTMR_AC_CNTACR_0_ADDR A:0x604a4040
y.create.l HWIO_MPM2_QTMR_AC_CNTVOFF_LO_0_ADDR A:0x604a4080
y.create.l HWIO_MPM2_QTMR_AC_CNTVOFF_HI_0_ADDR A:0x604a4084
y.create.l HWIO_MPM2_QTMR_AC_CFG_ADDR A:0x604a4fc0
y.create.l HWIO_MPM2_QTMR_AC_VERSION_ADDR A:0x604a4fd0
y.create.l HWIO_MPM2_QTMR_V1_CNTPCT_LO_ADDR A:0x604a5000
y.create.l HWIO_MPM2_QTMR_V1_CNTPCT_HI_ADDR A:0x604a5004
y.create.l HWIO_MPM2_QTMR_V1_CNTVCT_LO_ADDR A:0x604a5008
y.create.l HWIO_MPM2_QTMR_V1_CNTVCT_HI_ADDR A:0x604a500c
y.create.l HWIO_MPM2_QTMR_V1_CNTFRQ_ADDR A:0x604a5010
y.create.l HWIO_MPM2_QTMR_V1_CNTPL0ACR_ADDR A:0x604a5014
y.create.l HWIO_MPM2_QTMR_V1_CNTVOFF_LO_ADDR A:0x604a5018
y.create.l HWIO_MPM2_QTMR_V1_CNTVOFF_HI_ADDR A:0x604a501c
y.create.l HWIO_MPM2_QTMR_V1_CNTP_CVAL_LO_ADDR A:0x604a5020
y.create.l HWIO_MPM2_QTMR_V1_CNTP_CVAL_HI_ADDR A:0x604a5024
y.create.l HWIO_MPM2_QTMR_V1_CNTP_TVAL_ADDR A:0x604a5028
y.create.l HWIO_MPM2_QTMR_V1_CNTP_CTL_ADDR A:0x604a502c
y.create.l HWIO_MPM2_QTMR_V1_CNTV_CVAL_LO_ADDR A:0x604a5030
y.create.l HWIO_MPM2_QTMR_V1_CNTV_CVAL_HI_ADDR A:0x604a5034
y.create.l HWIO_MPM2_QTMR_V1_CNTV_TVAL_ADDR A:0x604a5038
y.create.l HWIO_MPM2_QTMR_V1_CNTV_CTL_ADDR A:0x604a503c
y.create.l HWIO_MPM2_QTMR_V1_VERSION_ADDR A:0x604a5fd0
y.create.l HWIO_MPM2_MPM_TSYNC_CTL_ADDR A:0x604a6000
y.create.l HWIO_MPM2_MPM_TSYNC_CMD_ADDR A:0x604a6004
y.create.l HWIO_MPM2_MPM_TSYNC_START_ADDR A:0x604a6008
y.create.l HWIO_MPM2_MPM_TSYNC_START_PHASE_ADDR A:0x604a600c
y.create.l HWIO_MPM2_MPM_TSYNC_PERIOD_ADDR A:0x604a6010
y.create.l HWIO_MPM2_MPM_TSYNC_PERIOD_PHASE_ADDR A:0x604a6014
y.create.l HWIO_MPM2_MPM_TSYNC_STATUS_TIME_ADDR A:0x604a6018
y.create.l HWIO_MPM2_MPM_TSYNC_STATUS_PHASE_ADDR A:0x604a601c
y.create.l HWIO_MPM2_MPM_GRFC_CXO_EN_ADDR A:0x604a6020
y.create.l HWIO_MPM2_XPU_SCR_ADDR A:0x604a7000
y.create.l HWIO_MPM2_XPU_SWDR_ADDR A:0x604a7004
y.create.l HWIO_MPM2_XPU_SEAR0_ADDR A:0x604a7040
y.create.l HWIO_MPM2_XPU_SESR_ADDR A:0x604a7048
y.create.l HWIO_MPM2_XPU_SESRRESTORE_ADDR A:0x604a704c
y.create.l HWIO_MPM2_XPU_SESYNR0_ADDR A:0x604a7050
y.create.l HWIO_MPM2_XPU_SESYNR1_ADDR A:0x604a7054
y.create.l HWIO_MPM2_XPU_SESYNR2_ADDR A:0x604a7058
y.create.l HWIO_MPM2_XPU_MCR_ADDR A:0x604a7100
y.create.l HWIO_MPM2_XPU_MEAR0_ADDR A:0x604a7140
y.create.l HWIO_MPM2_XPU_MESR_ADDR A:0x604a7148
y.create.l HWIO_MPM2_XPU_MESRRESTORE_ADDR A:0x604a714c
y.create.l HWIO_MPM2_XPU_MESYNR0_ADDR A:0x604a7150
y.create.l HWIO_MPM2_XPU_MESYNR1_ADDR A:0x604a7154
y.create.l HWIO_MPM2_XPU_MESYNR2_ADDR A:0x604a7158
y.create.l HWIO_MPM2_XPU_CR_ADDR A:0x604a7080
y.create.l HWIO_MPM2_XPU_RPU_ACR0_ADDR A:0x604a70a0
y.create.l HWIO_MPM2_XPU_EAR0_ADDR A:0x604a70c0
y.create.l HWIO_MPM2_XPU_ESR_ADDR A:0x604a70c8
y.create.l HWIO_MPM2_XPU_ESRRESTORE_ADDR A:0x604a70cc
y.create.l HWIO_MPM2_XPU_ESYNR0_ADDR A:0x604a70d0
y.create.l HWIO_MPM2_XPU_ESYNR1_ADDR A:0x604a70d4
y.create.l HWIO_MPM2_XPU_ESYNR2_ADDR A:0x604a70d8
y.create.l HWIO_MPM2_XPU_IDR0_ADDR A:0x604a7074
y.create.l HWIO_MPM2_XPU_IDR1_ADDR A:0x604a7078
y.create.l HWIO_MPM2_XPU_REV_ADDR A:0x604a707c
y.create.l HWIO_MPM2_XPU_RG0_RACR0_ADDR A:0x604a7200
y.create.l HWIO_MPM2_XPU_RG1_RACR0_ADDR A:0x604a7280
y.create.l HWIO_MPM2_XPU_RG2_RACR0_ADDR A:0x604a7300
y.create.l HWIO_MPM2_XPU_RG3_RACR0_ADDR A:0x604a7380
y.create.l HWIO_MPM2_XPU_RG4_RACR0_ADDR A:0x604a7400
y.create.l HWIO_MPM2_XPU_RG5_RACR0_ADDR A:0x604a7480
y.create.l HWIO_MPM2_XPU_RG6_RACR0_ADDR A:0x604a7500
y.create.l HWIO_MPM2_XPU_RG7_RACR0_ADDR A:0x604a7580
y.create.l HWIO_MPM2_XPU_RG8_RACR0_ADDR A:0x604a7600
y.create.l HWIO_MPM2_XPU_RG9_RACR0_ADDR A:0x604a7680
y.create.l HWIO_MPM2_XPU_RG0_SCR_ADDR A:0x604a7250
y.create.l HWIO_MPM2_XPU_RG1_SCR_ADDR A:0x604a72d0
y.create.l HWIO_MPM2_XPU_RG2_SCR_ADDR A:0x604a7350
y.create.l HWIO_MPM2_XPU_RG3_SCR_ADDR A:0x604a73d0
y.create.l HWIO_MPM2_XPU_RG4_SCR_ADDR A:0x604a7450
y.create.l HWIO_MPM2_XPU_RG5_SCR_ADDR A:0x604a74d0
y.create.l HWIO_MPM2_XPU_RG6_SCR_ADDR A:0x604a7550
y.create.l HWIO_MPM2_XPU_RG7_SCR_ADDR A:0x604a75d0
y.create.l HWIO_MPM2_XPU_RG8_SCR_ADDR A:0x604a7650
y.create.l HWIO_MPM2_XPU_RG9_SCR_ADDR A:0x604a76d0
y.create.l HWIO_MPM2_XPU_RG0_MCR_ADDR A:0x604a7254
y.create.l HWIO_MPM2_XPU_RG1_MCR_ADDR A:0x604a72d4
y.create.l HWIO_MPM2_XPU_RG2_MCR_ADDR A:0x604a7354
y.create.l HWIO_MPM2_XPU_RG3_MCR_ADDR A:0x604a73d4
y.create.l HWIO_MPM2_XPU_RG4_MCR_ADDR A:0x604a7454
y.create.l HWIO_MPM2_XPU_RG5_MCR_ADDR A:0x604a74d4
y.create.l HWIO_MPM2_XPU_RG6_MCR_ADDR A:0x604a7554
y.create.l HWIO_MPM2_XPU_RG7_MCR_ADDR A:0x604a75d4
y.create.l HWIO_MPM2_XPU_RG8_MCR_ADDR A:0x604a7654
y.create.l HWIO_MPM2_XPU_RG9_MCR_ADDR A:0x604a76d4
y.create.l HWIO_MPM2_TSENS_HW_VER_ADDR A:0x604a8000
y.create.l HWIO_MPM2_TSENS_CTRL_ADDR A:0x604a8004
y.create.l HWIO_MPM2_TSENS_TEST_CTRL_ADDR A:0x604a8008
y.create.l HWIO_MPM2_TSENS_S0_MIN_MAX_STATUS_CTRL_ADDR A:0x604a800c
y.create.l HWIO_MPM2_TSENS_S1_MIN_MAX_STATUS_CTRL_ADDR A:0x604a8010
y.create.l HWIO_MPM2_TSENS_S2_MIN_MAX_STATUS_CTRL_ADDR A:0x604a8014
y.create.l HWIO_MPM2_TSENS_S3_MIN_MAX_STATUS_CTRL_ADDR A:0x604a8018
y.create.l HWIO_MPM2_TSENS_S4_MIN_MAX_STATUS_CTRL_ADDR A:0x604a801c
y.create.l HWIO_MPM2_TSENS_S5_MIN_MAX_STATUS_CTRL_ADDR A:0x604a8020
y.create.l HWIO_MPM2_TSENS_S6_MIN_MAX_STATUS_CTRL_ADDR A:0x604a8024
y.create.l HWIO_MPM2_TSENS_S7_MIN_MAX_STATUS_CTRL_ADDR A:0x604a8028
y.create.l HWIO_MPM2_TSENS_S8_MIN_MAX_STATUS_CTRL_ADDR A:0x604a802c
y.create.l HWIO_MPM2_TSENS_S9_MIN_MAX_STATUS_CTRL_ADDR A:0x604a8030
y.create.l HWIO_MPM2_TSENS_GLOBAL_CONFIG_ADDR A:0x604a804c
y.create.l HWIO_MPM2_TSENS_SENSOR_CONFIG_ADDR A:0x604a8050
y.create.l HWIO_MPM2_TSENS_CONFIG_REMOTE_IN_ADDR A:0x604a8054
y.create.l HWIO_MPM2_TSENS_UPPER_LOWER_INTERRUPT_CTRL_ADDR A:0x604a9000
y.create.l HWIO_MPM2_TSENS_S0_UPPER_LOWER_STATUS_CTRL_ADDR A:0x604a9004
y.create.l HWIO_MPM2_TSENS_S1_UPPER_LOWER_STATUS_CTRL_ADDR A:0x604a9008
y.create.l HWIO_MPM2_TSENS_S2_UPPER_LOWER_STATUS_CTRL_ADDR A:0x604a900c
y.create.l HWIO_MPM2_TSENS_S3_UPPER_LOWER_STATUS_CTRL_ADDR A:0x604a9010
y.create.l HWIO_MPM2_TSENS_S4_UPPER_LOWER_STATUS_CTRL_ADDR A:0x604a9014
y.create.l HWIO_MPM2_TSENS_S5_UPPER_LOWER_STATUS_CTRL_ADDR A:0x604a9018
y.create.l HWIO_MPM2_TSENS_S6_UPPER_LOWER_STATUS_CTRL_ADDR A:0x604a901c
y.create.l HWIO_MPM2_TSENS_S7_UPPER_LOWER_STATUS_CTRL_ADDR A:0x604a9020
y.create.l HWIO_MPM2_TSENS_S8_UPPER_LOWER_STATUS_CTRL_ADDR A:0x604a9024
y.create.l HWIO_MPM2_TSENS_S9_UPPER_LOWER_STATUS_CTRL_ADDR A:0x604a9028
y.create.l HWIO_MPM2_TSENS_S0_STATUS_ADDR A:0x604a9044
y.create.l HWIO_MPM2_TSENS_S1_STATUS_ADDR A:0x604a9048
y.create.l HWIO_MPM2_TSENS_S2_STATUS_ADDR A:0x604a904c
y.create.l HWIO_MPM2_TSENS_S3_STATUS_ADDR A:0x604a9050
y.create.l HWIO_MPM2_TSENS_S4_STATUS_ADDR A:0x604a9054
y.create.l HWIO_MPM2_TSENS_S5_STATUS_ADDR A:0x604a9058
y.create.l HWIO_MPM2_TSENS_S6_STATUS_ADDR A:0x604a905c
y.create.l HWIO_MPM2_TSENS_S7_STATUS_ADDR A:0x604a9060
y.create.l HWIO_MPM2_TSENS_S8_STATUS_ADDR A:0x604a9064
y.create.l HWIO_MPM2_TSENS_S9_STATUS_ADDR A:0x604a9068
y.create.l HWIO_MPM2_TSENS_TRDY_ADDR A:0x604a9084
y.create.l HWIO_MPM2_WDOG_RESET_REG_ADDR A:0x604aa000
y.create.l HWIO_MPM2_WDOG_CTL_REG_ADDR A:0x604aa004
y.create.l HWIO_MPM2_WDOG_STATUS_REG_ADDR A:0x604aa008
y.create.l HWIO_MPM2_WDOG_BARK_VAL_REG_ADDR A:0x604aa00c
y.create.l HWIO_MPM2_WDOG_BITE_VAL_REG_ADDR A:0x604aa010
y.create.l HWIO_MPM2_MPM_PS_HOLD_ADDR A:0x604ab000
y.create.l HWIO_MPM2_MPM_DDR_PHY_FREEZEIO_EBI1_ADDR A:0x604ab004
y.create.l HWIO_MPM2_MPM_WCSSAON_CONFIG_ADDR A:0x604ab008
y.create.l HWIO_MPM2_MPM_WCSSAON_STATUS_ADDR A:0x604ab00c
y.create.l HWIO_MX_RBCPR_VERSION_ADDR A:0x60070000
y.create.l HWIO_MX_RBCPR_SENSOR_MASK0_ADDR A:0x60070020
y.create.l HWIO_MX_RBCPR_SENSOR_MASK1_ADDR A:0x60070024
y.create.l HWIO_MX_RBCPR_SENSOR_MASK2_ADDR A:0x60070028
y.create.l HWIO_MX_RBCPR_SENSOR_MASK3_ADDR A:0x6007002c
y.create.l HWIO_MX_RBCPR_SENSOR_BYPASS0_ADDR A:0x60070030
y.create.l HWIO_MX_RBCPR_SENSOR_BYPASS1_ADDR A:0x60070034
y.create.l HWIO_MX_RBCPR_SENSOR_BYPASS2_ADDR A:0x60070038
y.create.l HWIO_MX_RBCPR_SENSOR_BYPASS3_ADDR A:0x6007003c
y.create.l HWIO_MX_RBIF_PMIC_ADDR_ADDR A:0x60070040
y.create.l HWIO_MX_RBCPR_TIMER_INTERVAL_ADDR A:0x60070044
y.create.l HWIO_MX_RBIF_LIMIT_ADDR A:0x60070048
y.create.l HWIO_MX_RBIF_TIMER_ADJUST_ADDR A:0x6007004c
y.create.l HWIO_MX_RBCPR_GCNT_TARGET0_ADDR A:0x60070060
y.create.l HWIO_MX_RBCPR_GCNT_TARGET1_ADDR A:0x60070064
y.create.l HWIO_MX_RBCPR_GCNT_TARGET2_ADDR A:0x60070068
y.create.l HWIO_MX_RBCPR_GCNT_TARGET3_ADDR A:0x6007006c
y.create.l HWIO_MX_RBCPR_GCNT_TARGET4_ADDR A:0x60070070
y.create.l HWIO_MX_RBCPR_GCNT_TARGET5_ADDR A:0x60070074
y.create.l HWIO_MX_RBCPR_GCNT_TARGET6_ADDR A:0x60070078
y.create.l HWIO_MX_RBCPR_GCNT_TARGET7_ADDR A:0x6007007c
y.create.l HWIO_MX_RBCPR_STEP_QUOT_ADDR A:0x60070080
y.create.l HWIO_MX_RBCPR_CTL_ADDR A:0x60070090
y.create.l HWIO_MX_RBIF_SW_VLEVEL_ADDR A:0x60070094
y.create.l HWIO_MX_RBIF_CONT_ACK_CMD_ADDR A:0x60070098
y.create.l HWIO_MX_RBIF_CONT_NACK_CMD_ADDR A:0x6007009c
y.create.l HWIO_MX_RBCPR_RESULT_0_ADDR A:0x600700a0
y.create.l HWIO_MX_RBCPR_RESULT_1_ADDR A:0x600700a4
y.create.l HWIO_MX_RBIF_IRQ_EN_0_ADDR A:0x60070100
y.create.l HWIO_MX_RBIF_IRQ_EN_1_ADDR A:0x60070104
y.create.l HWIO_MX_RBIF_IRQ_EN_2_ADDR A:0x60070108
y.create.l HWIO_MX_RBIF_IRQ_CLEAR_ADDR A:0x60070110
y.create.l HWIO_MX_RBIF_IRQ_STATUS_ADDR A:0x60070114
y.create.l HWIO_MX_RBCPR_QUOT_AVG_ADDR A:0x60070118
y.create.l HWIO_MX_RBCPR_DEBUG0_ADDR A:0x6007011c
y.create.l HWIO_MX_RBCPR_DEBUG1_ADDR A:0x60070120
y.create.l HWIO_MX_RBCPR_DEBUG2_ADDR A:0x60070124
y.create.l HWIO_MX_RBCPR_BIST_MINMAX_ADDR A:0x60070128
y.create.l HWIO_MX_RBCPR_BIST_RESULT_ADDR A:0x6007012c
y.create.l HWIO_MX_RBCPR_BIST_FAIL_MAP0_ADDR A:0x60070130
y.create.l HWIO_MX_RBCPR_BIST_FAIL_MAP1_ADDR A:0x60070134
y.create.l HWIO_MX_RBCPR_BIST_FAIL_MAP2_ADDR A:0x60070138
y.create.l HWIO_MX_RBCPR_BIST_FAIL_MAP3_ADDR A:0x6007013c
y.create.l HWIO_MX_RBCPR_LOG_0_ADDR A:0x60070140
y.create.l HWIO_MX_RBCPR_LOG_1_ADDR A:0x60070144
y.create.l HWIO_MX_RBCPR_LOG_2_ADDR A:0x60070148
y.create.l HWIO_MX_RBCPR_LOG_3_ADDR A:0x6007014c
y.create.l HWIO_MX_RBCPR_LOG_4_ADDR A:0x60070150
y.create.l HWIO_MX_RBCPR_LOG_5_ADDR A:0x60070154
y.create.l HWIO_MX_RBCPR_LOG_6_ADDR A:0x60070158
y.create.l HWIO_MX_RBCPR_LOG_7_ADDR A:0x6007015c
y.create.l HWIO_MX_RBCPR_HTOL_AGE_ADDR A:0x60070160
y.create.l HWIO_OCIMEM_HW_VERSION_ADDR A:0x60050000
y.create.l HWIO_OCIMEM_HW_PROFILE_ADDR A:0x60050004
y.create.l HWIO_OCIMEM_GEN_CTL_ADDR A:0x60050008
y.create.l HWIO_OCIMEM_GEN_STAT_ADDR A:0x6005000c
y.create.l HWIO_OCIMEM_INTC_CLR_ADDR A:0x60050010
y.create.l HWIO_OCIMEM_INTC_MASK_ADDR A:0x60050014
y.create.l HWIO_OCIMEM_INTC_STAT_ADDR A:0x60050018
y.create.l HWIO_OCIMEM_OSW_STATUS_ADDR A:0x6005001c
y.create.l HWIO_OCIMEM_PSCGC_TIMERS_ADDR A:0x60050034
y.create.l HWIO_OCIMEM_PSCGC_STAT_ADDR A:0x60050038
y.create.l HWIO_OCIMEM_PSCGC_M0_M7_CTL_ADDR A:0x6005003c
y.create.l HWIO_OCIMEM_ERR_ADDRESS_ADDR A:0x60050060
y.create.l HWIO_OCIMEM_AXI_ERR_SYNDROME_ADDR A:0x60050064
y.create.l HWIO_OCIMEM_DEBUG_CTL_ADDR A:0x60050068
y.create.l HWIO_OCIMEM_MPU_XPU_SCR_ADDR A:0x60053000
y.create.l HWIO_OCIMEM_MPU_XPU_SWDR_ADDR A:0x60053004
y.create.l HWIO_OCIMEM_MPU_XPU_PRTN_RACR_SSHADOW_ADDR A:0x60053008
y.create.l HWIO_OCIMEM_MPU_XPU_PRTN_WACR_SSHADOW_ADDR A:0x6005300c
y.create.l HWIO_OCIMEM_MPU_XPU_PRTN_START_SSHADOW0_ADDR A:0x60053010
y.create.l HWIO_OCIMEM_MPU_XPU_PRTN_END_SSHADOW0_ADDR A:0x60053018
y.create.l HWIO_OCIMEM_MPU_XPU_SEAR0_ADDR A:0x60053040
y.create.l HWIO_OCIMEM_MPU_XPU_SESR_ADDR A:0x60053048
y.create.l HWIO_OCIMEM_MPU_XPU_SESRRESTORE_ADDR A:0x6005304c
y.create.l HWIO_OCIMEM_MPU_XPU_SESYNR0_ADDR A:0x60053050
y.create.l HWIO_OCIMEM_MPU_XPU_SESYNR1_ADDR A:0x60053054
y.create.l HWIO_OCIMEM_MPU_XPU_SESYNR2_ADDR A:0x60053058
y.create.l HWIO_OCIMEM_MPU_XPU_MCR_ADDR A:0x60053100
y.create.l HWIO_OCIMEM_MPU_XPU_MEAR0_ADDR A:0x60053140
y.create.l HWIO_OCIMEM_MPU_XPU_MESR_ADDR A:0x60053148
y.create.l HWIO_OCIMEM_MPU_XPU_MESRRESTORE_ADDR A:0x6005314c
y.create.l HWIO_OCIMEM_MPU_XPU_MESYNR0_ADDR A:0x60053150
y.create.l HWIO_OCIMEM_MPU_XPU_MESYNR1_ADDR A:0x60053154
y.create.l HWIO_OCIMEM_MPU_XPU_MESYNR2_ADDR A:0x60053158
y.create.l HWIO_OCIMEM_MPU_XPU_CR_ADDR A:0x60053080
y.create.l HWIO_OCIMEM_MPU_XPU_PRTN_RACR_SHADOW_ADDR A:0x60053088
y.create.l HWIO_OCIMEM_MPU_XPU_PRTN_WACR_SHADOW_ADDR A:0x6005308c
y.create.l HWIO_OCIMEM_MPU_XPU_PRTN_START_SHADOW0_ADDR A:0x60053090
y.create.l HWIO_OCIMEM_MPU_XPU_PRTN_END_SHADOW0_ADDR A:0x60053098
y.create.l HWIO_OCIMEM_MPU_XPU_RPU_ACR0_ADDR A:0x600530a0
y.create.l HWIO_OCIMEM_MPU_XPU_EAR0_ADDR A:0x600530c0
y.create.l HWIO_OCIMEM_MPU_XPU_ESR_ADDR A:0x600530c8
y.create.l HWIO_OCIMEM_MPU_XPU_ESRRESTORE_ADDR A:0x600530cc
y.create.l HWIO_OCIMEM_MPU_XPU_ESYNR0_ADDR A:0x600530d0
y.create.l HWIO_OCIMEM_MPU_XPU_ESYNR1_ADDR A:0x600530d4
y.create.l HWIO_OCIMEM_MPU_XPU_ESYNR2_ADDR A:0x600530d8
y.create.l HWIO_OCIMEM_MPU_XPU_UMR_RACR_ADDR A:0x600530e0
y.create.l HWIO_OCIMEM_MPU_XPU_UMR_WACR_ADDR A:0x600530e4
y.create.l HWIO_OCIMEM_MPU_XPU_UMR_CNTL_ADDR A:0x600530f0
y.create.l HWIO_OCIMEM_MPU_XPU_IDR0_ADDR A:0x60053074
y.create.l HWIO_OCIMEM_MPU_XPU_IDR1_ADDR A:0x60053078
y.create.l HWIO_OCIMEM_MPU_XPU_REV_ADDR A:0x6005307c
y.create.l HWIO_OCIMEM_MPU_XPU_PRT0_RACR0_ADDR A:0x60053200
y.create.l HWIO_OCIMEM_MPU_XPU_PRT1_RACR0_ADDR A:0x60053280
y.create.l HWIO_OCIMEM_MPU_XPU_PRT2_RACR0_ADDR A:0x60053300
y.create.l HWIO_OCIMEM_MPU_XPU_PRT3_RACR0_ADDR A:0x60053380
y.create.l HWIO_OCIMEM_MPU_XPU_PRT4_RACR0_ADDR A:0x60053400
y.create.l HWIO_OCIMEM_MPU_XPU_PRT5_RACR0_ADDR A:0x60053480
y.create.l HWIO_OCIMEM_MPU_XPU_PRT6_RACR0_ADDR A:0x60053500
y.create.l HWIO_OCIMEM_MPU_XPU_PRT7_RACR0_ADDR A:0x60053580
y.create.l HWIO_OCIMEM_MPU_XPU_PRT0_WACR0_ADDR A:0x60053220
y.create.l HWIO_OCIMEM_MPU_XPU_PRT1_WACR0_ADDR A:0x600532a0
y.create.l HWIO_OCIMEM_MPU_XPU_PRT2_WACR0_ADDR A:0x60053320
y.create.l HWIO_OCIMEM_MPU_XPU_PRT3_WACR0_ADDR A:0x600533a0
y.create.l HWIO_OCIMEM_MPU_XPU_PRT4_WACR0_ADDR A:0x60053420
y.create.l HWIO_OCIMEM_MPU_XPU_PRT5_WACR0_ADDR A:0x600534a0
y.create.l HWIO_OCIMEM_MPU_XPU_PRT6_WACR0_ADDR A:0x60053520
y.create.l HWIO_OCIMEM_MPU_XPU_PRT7_WACR0_ADDR A:0x600535a0
y.create.l HWIO_OCIMEM_MPU_XPU_PRT0_START0_ADDR A:0x60053240
y.create.l HWIO_OCIMEM_MPU_XPU_PRT1_START0_ADDR A:0x600532c0
y.create.l HWIO_OCIMEM_MPU_XPU_PRT2_START0_ADDR A:0x60053340
y.create.l HWIO_OCIMEM_MPU_XPU_PRT3_START0_ADDR A:0x600533c0
y.create.l HWIO_OCIMEM_MPU_XPU_PRT4_START0_ADDR A:0x60053440
y.create.l HWIO_OCIMEM_MPU_XPU_PRT5_START0_ADDR A:0x600534c0
y.create.l HWIO_OCIMEM_MPU_XPU_PRT6_START0_ADDR A:0x60053540
y.create.l HWIO_OCIMEM_MPU_XPU_PRT7_START0_ADDR A:0x600535c0
y.create.l HWIO_OCIMEM_MPU_XPU_PRT0_END0_ADDR A:0x60053248
y.create.l HWIO_OCIMEM_MPU_XPU_PRT1_END0_ADDR A:0x600532c8
y.create.l HWIO_OCIMEM_MPU_XPU_PRT2_END0_ADDR A:0x60053348
y.create.l HWIO_OCIMEM_MPU_XPU_PRT3_END0_ADDR A:0x600533c8
y.create.l HWIO_OCIMEM_MPU_XPU_PRT4_END0_ADDR A:0x60053448
y.create.l HWIO_OCIMEM_MPU_XPU_PRT5_END0_ADDR A:0x600534c8
y.create.l HWIO_OCIMEM_MPU_XPU_PRT6_END0_ADDR A:0x60053548
y.create.l HWIO_OCIMEM_MPU_XPU_PRT7_END0_ADDR A:0x600535c8
y.create.l HWIO_OCIMEM_MPU_XPU_PRT0_SCR_ADDR A:0x60053250
y.create.l HWIO_OCIMEM_MPU_XPU_PRT1_SCR_ADDR A:0x600532d0
y.create.l HWIO_OCIMEM_MPU_XPU_PRT2_SCR_ADDR A:0x60053350
y.create.l HWIO_OCIMEM_MPU_XPU_PRT3_SCR_ADDR A:0x600533d0
y.create.l HWIO_OCIMEM_MPU_XPU_PRT4_SCR_ADDR A:0x60053450
y.create.l HWIO_OCIMEM_MPU_XPU_PRT5_SCR_ADDR A:0x600534d0
y.create.l HWIO_OCIMEM_MPU_XPU_PRT6_SCR_ADDR A:0x60053550
y.create.l HWIO_OCIMEM_MPU_XPU_PRT7_SCR_ADDR A:0x600535d0
y.create.l HWIO_OCIMEM_MPU_XPU_PRT0_MCR_ADDR A:0x60053254
y.create.l HWIO_OCIMEM_MPU_XPU_PRT1_MCR_ADDR A:0x600532d4
y.create.l HWIO_OCIMEM_MPU_XPU_PRT2_MCR_ADDR A:0x60053354
y.create.l HWIO_OCIMEM_MPU_XPU_PRT3_MCR_ADDR A:0x600533d4
y.create.l HWIO_OCIMEM_MPU_XPU_PRT4_MCR_ADDR A:0x60053454
y.create.l HWIO_OCIMEM_MPU_XPU_PRT5_MCR_ADDR A:0x600534d4
y.create.l HWIO_OCIMEM_MPU_XPU_PRT6_MCR_ADDR A:0x60053554
y.create.l HWIO_OCIMEM_MPU_XPU_PRT7_MCR_ADDR A:0x600535d4
y.create.l HWIO_OCIMEM_MPU_XPU_PRT0_CNTL0_ADDR A:0x60053258
y.create.l HWIO_OCIMEM_MPU_XPU_PRT1_CNTL0_ADDR A:0x600532d8
y.create.l HWIO_OCIMEM_MPU_XPU_PRT2_CNTL0_ADDR A:0x60053358
y.create.l HWIO_OCIMEM_MPU_XPU_PRT3_CNTL0_ADDR A:0x600533d8
y.create.l HWIO_OCIMEM_MPU_XPU_PRT4_CNTL0_ADDR A:0x60053458
y.create.l HWIO_OCIMEM_MPU_XPU_PRT5_CNTL0_ADDR A:0x600534d8
y.create.l HWIO_OCIMEM_MPU_XPU_PRT6_CNTL0_ADDR A:0x60053558
y.create.l HWIO_OCIMEM_MPU_XPU_PRT7_CNTL0_ADDR A:0x600535d8
y.create.l HWIO_OCIMEM_MPU_XPU_PRT0_CNTL1_ADDR A:0x6005325c
y.create.l HWIO_OCIMEM_MPU_XPU_PRT1_CNTL1_ADDR A:0x600532dc
y.create.l HWIO_OCIMEM_MPU_XPU_PRT2_CNTL1_ADDR A:0x6005335c
y.create.l HWIO_OCIMEM_MPU_XPU_PRT3_CNTL1_ADDR A:0x600533dc
y.create.l HWIO_OCIMEM_MPU_XPU_PRT4_CNTL1_ADDR A:0x6005345c
y.create.l HWIO_OCIMEM_MPU_XPU_PRT5_CNTL1_ADDR A:0x600534dc
y.create.l HWIO_OCIMEM_MPU_XPU_PRT6_CNTL1_ADDR A:0x6005355c
y.create.l HWIO_OCIMEM_MPU_XPU_PRT7_CNTL1_ADDR A:0x600535dc
y.create.l HWIO_PCIE_0_PCIE20_PARF_SYS_CTRL_ADDR A:0x60080000
y.create.l HWIO_PCIE_0_PCIE20_PARF_BRIDGE_ERR_MAP_ADDR A:0x60080008
y.create.l HWIO_PCIE_0_PCIE20_PARF_DB_CTRL_ADDR A:0x60080010
y.create.l HWIO_PCIE_0_PCIE20_PARF_PREDET_DB_INSR_ADDR A:0x60080014
y.create.l HWIO_PCIE_0_PCIE20_PARF_PREDET_DB_RMVL_ADDR A:0x60080018
y.create.l HWIO_PCIE_0_PCIE20_PARF_WKP_DB_RMVL_ADDR A:0x6008001c
y.create.l HWIO_PCIE_0_PCIE20_PARF_PM_CTRL_ADDR A:0x60080020
y.create.l HWIO_PCIE_0_PCIE20_PARF_PM_STTS_ADDR A:0x60080024
y.create.l HWIO_PCIE_0_PCIE20_PARF_PM_STTS_1_ADDR A:0x60080028
y.create.l HWIO_PCIE_0_PCIE20_PARF_PCS_CTRL_ADDR A:0x60080030
y.create.l HWIO_PCIE_0_PCIE20_PARF_PCS_DEEMPH_ADDR A:0x60080034
y.create.l HWIO_PCIE_0_PCIE20_PARF_PCS_SWING_ADDR A:0x60080038
y.create.l HWIO_PCIE_0_PCIE20_PARF_PHY_CTRL_ADDR A:0x60080040
y.create.l HWIO_PCIE_0_PCIE20_PARF_PHY_STTS_ADDR A:0x60080044
y.create.l HWIO_PCIE_0_PCIE20_PARF_PHY_REFCLK_ADDR A:0x6008004c
y.create.l HWIO_PCIE_0_PCIE20_PARF_CONFIG_BITS_ADDR A:0x60080050
y.create.l HWIO_PCIE_0_PCIE20_PARF_AXI_CONFIG_ADDR A:0x60080054
y.create.l HWIO_PCIE_0_PCIE20_PARF_HW_EV_0_ADDR A:0x60080058
y.create.l HWIO_PCIE_0_PCIE20_PARF_HW_EV_1_ADDR A:0x6008005c
y.create.l HWIO_PCIE_0_PCIE20_PARF_HW_EV_2_ADDR A:0x60080060
y.create.l HWIO_PCIE_0_PCIE20_PARF_HW_EV_3_ADDR A:0x60080064
y.create.l HWIO_PCIE_0_PCIE20_PARF_HW_EV_4_ADDR A:0x60080068
y.create.l HWIO_PCIE_0_PCIE20_PARF_HW_EV_5_ADDR A:0x6008006c
y.create.l HWIO_PCIE_0_PCIE20_PARF_HW_EV_6_ADDR A:0x60080070
y.create.l HWIO_PCIE_0_PCIE20_PARF_HW_EV_7_ADDR A:0x60080074
y.create.l HWIO_PCIE_0_PCIE20_PARF_HW_EV_8_ADDR A:0x60080078
y.create.l HWIO_PCIE_0_PCIE20_PARF_HW_EV_9_ADDR A:0x6008007c
y.create.l HWIO_PCIE_0_PCIE20_PARF_Q2A_BRIDGE_CTRL_ADDR A:0x600800dc
y.create.l HWIO_PCIE_0_PCIE20_PARF_SLV_BASE_ADDR_ADDR A:0x600800e0
y.create.l HWIO_PCIE_0_PCIE20_PARF_TEST_BUS_ADDR A:0x600800e4
y.create.l HWIO_PCIE_0_PCIE20_PARF_MSG_ADDR_0_ADDR A:0x600800e8
y.create.l HWIO_PCIE_0_PCIE20_PARF_MSG_ADDR_1_ADDR A:0x600800ec
y.create.l HWIO_PCIE_0_PCIE20_PARF_MSG_ADDR_2_ADDR A:0x600800f0
y.create.l HWIO_PCIE_0_PCIE20_PARF_MSG_ADDR_3_ADDR A:0x600800f4
y.create.l HWIO_PCIE_0_PCIE20_PARF_MSG_ADDR_4_ADDR A:0x600800f8
y.create.l HWIO_PCIE_0_PCIE20_PARF_MSG_ADDR_5_ADDR A:0x600800fc
y.create.l HWIO_PCIE_0_PCIE20_PARF_MSG_ADDR_6_ADDR A:0x60080100
y.create.l HWIO_PCIE_0_PCIE20_PARF_MSG_ADDR_7_ADDR A:0x60080104
y.create.l HWIO_PCIE_0_PCIE20_PARF_MSG_ADDR_8_ADDR A:0x60080108
y.create.l HWIO_PCIE_0_PCIE20_PARF_MSG_ADDR_9_ADDR A:0x6008010c
y.create.l HWIO_PCIE_0_PCIE20_PARF_MSG_PARAMS_0_ADDR A:0x60080128
y.create.l HWIO_PCIE_0_PCIE20_PARF_MSG_PARAMS_1_ADDR A:0x6008012c
y.create.l HWIO_PCIE_0_PCIE20_PARF_MSG_PARAMS_2_ADDR A:0x60080130
y.create.l HWIO_PCIE_0_PCIE20_PARF_MSG_PARAMS_3_ADDR A:0x60080134
y.create.l HWIO_PCIE_0_PCIE20_PARF_MSG_PARAMS_4_ADDR A:0x60080138
y.create.l HWIO_PCIE_0_PCIE20_PARF_MSG_PARAMS_5_ADDR A:0x6008013c
y.create.l HWIO_PCIE_0_PCIE20_PARF_MSG_PARAMS_6_ADDR A:0x60080140
y.create.l HWIO_PCIE_0_PCIE20_PARF_MSG_PARAMS_7_ADDR A:0x60080144
y.create.l HWIO_PCIE_0_PCIE20_PARF_MSG_PARAMS_8_ADDR A:0x60080148
y.create.l HWIO_PCIE_0_PCIE20_PARF_MSG_PARAMS_9_ADDR A:0x6008014c
y.create.l HWIO_PCIE_0_PCIE20_PARF_DBI_BASE_ADDR_ADDR A:0x60080168
y.create.l HWIO_PCIE_0_PCIE20_PARF_SLV_ADDR_SPACE_SIZE_ADDR A:0x6008016c
y.create.l HWIO_PCIE_0_PCIE20_PARF_VERSION_ADDR A:0x60080170
y.create.l HWIO_PCIE_0_PCIE20_PARF_MHI_CLOCK_RESET_CTRL_ADDR A:0x60080174
y.create.l HWIO_PCIE_0_PCIE20_PARF_MHI_BASE_ADDR_LOWER_ADDR A:0x60080178
y.create.l HWIO_PCIE_0_PCIE20_PARF_MHI_BASE_ADDR_UPPER_ADDR A:0x6008017c
y.create.l HWIO_PCIE_0_PCIE20_PARF_L1SUB_AHB_CLK_MAX_TIMER_ADDR A:0x60080180
y.create.l HWIO_PCIE_0_PCIE20_PARF_LTR_MSG_GEN_ADDR A:0x60080184
y.create.l HWIO_PCIE_0_PCIE20_PARF_MSI_GEN_ADDR A:0x60080188
y.create.l HWIO_PCIE_0_PCIE20_PARF_AXI_MSTR_OUTST_LIMIT_ADDR A:0x6008018c
y.create.l HWIO_PCIE_0_PCIE20_PARF_DEBUG_INT_EN_ADDR A:0x60080190
y.create.l HWIO_PCIE_0_PCIE20_PARF_MHI_BAR_KB_SIZE_ADDR A:0x60080194
y.create.l HWIO_PCIE_0_PCIE20_PARF_MHI_IPA_DBS_ADDR A:0x60080198
y.create.l HWIO_PCIE_0_PCIE20_PARF_MHI_IPA_CDB_TARGET_LOWER_ADDR A:0x6008019c
y.create.l HWIO_PCIE_0_PCIE20_PARF_MHI_IPA_EDB_TARGET_LOWER_ADDR A:0x600801a0
y.create.l HWIO_PCIE_0_PCIE20_PARF_AXI_MSTR_RD_HALT_NO_WRITES_ADDR A:0x600801a4
y.create.l HWIO_PCIE_0_PCIE20_PARF_AXI_MSTR_WR_ADDR_HALT_ADDR A:0x600801a8
y.create.l HWIO_PCIE_0_PCIE20_PARF_LTSSM_ADDR A:0x600801b0
y.create.l HWIO_PCIE_0_PCIE20_PARF_SLV_DBI_ELBI_ADDR A:0x600801b4
y.create.l HWIO_PCIE_0_PCIE20_PARF_BLOCK_SLV_AXI_WR_BASE_ADDR A:0x600801b8
y.create.l HWIO_PCIE_0_PCIE20_PARF_BLOCK_SLV_AXI_WR_LIMIT_ADDR A:0x600801bc
y.create.l HWIO_PCIE_0_PCIE20_PARF_BLOCK_SLV_AXI_RD_BASE_ADDR A:0x600801c0
y.create.l HWIO_PCIE_0_PCIE20_PARF_BLOCK_SLV_AXI_RD_LIMIT_ADDR A:0x600801c4
y.create.l HWIO_PCIE_0_PCIE20_PARF_BLOCK_SLV_AXI_DEBUG_ADDR A:0x600801c8
y.create.l HWIO_PCIE_0_PCIE20_PARF_ECAM_BASE_ADDR A:0x600801cc
y.create.l HWIO_PCIE_0_PCIE20_PARF_ECAM_OFFSET_REMOVAL_BASE_ADDR A:0x600801d0
y.create.l HWIO_PCIE_0_PCIE20_PARF_ECAM_OFFSET_REMOVAL_LIMIT_ADDR A:0x600801d4
y.create.l HWIO_PCIE_0_PCIE20_PARF_SPARE_0_1_BITS_ADDR A:0x600801d8
y.create.l HWIO_PCIE_0_PCIE20_PARF_RELEASE_VERSION_ADDR A:0x600801dc
y.create.l HWIO_PCIE_0_PCIE20_PARF_CFG_MSI_PENDING_SET_ADDR A:0x600801e0
y.create.l HWIO_PCIE_0_PCIE20_PARF_CFG_MSI_PENDING_CLEAR_ADDR A:0x600801e4
y.create.l HWIO_PCIE_0_PCIE20_PARF_CFG_MSI_PENDING_ADDR A:0x600801e8
y.create.l HWIO_PCIE_0_PCIE20_PARF_CFG_MSI_MASK_ADDR A:0x600801ec
y.create.l HWIO_PCIE_0_PCIE20_PARF_CFG_MSI_MASK_INT_STATUS_ADDR A:0x600801f0
y.create.l HWIO_PCIE_0_PCIE20_PARF_CFG_MSI_MASK_INT_MASK_ADDR A:0x600801f4
y.create.l HWIO_PCIE_0_PCIE20_PARF_CFG_MSI_MASK_INT_CLEAR_ADDR A:0x600801f8
y.create.l HWIO_PCIE_0_PCIE20_PARF_CFG_BITS_ADDR A:0x60080210
y.create.l HWIO_PCIE_0_PCIE20_PARF_LTR_MSI_EXIT_L1SS_ADDR A:0x60080214
y.create.l HWIO_PCIE_0_PCIE20_PARF_INT_MASK_ADDR A:0x60080218
y.create.l HWIO_PCIE_0_PCIE20_PARF_INT_CLEAR_ADDR A:0x6008021c
y.create.l HWIO_PCIE_0_PCIE20_PARF_INT_STATUS_ADDR A:0x60080220
y.create.l HWIO_PCIE_0_PCIE20_INT_ALL_STATUS_ADDR A:0x60080224
y.create.l HWIO_PCIE_0_PCIE20_INT_ALL_CLEAR_ADDR A:0x60080228
y.create.l HWIO_PCIE_0_PCIE20_STATUS_ADDR A:0x6008022c
y.create.l HWIO_PCIE_0_PCIE20_PARF_DEVICE_TYPE_ADDR A:0x60081000
y.create.l HWIO_PCIE_0_QSERDES_COM_SYS_CLK_CTRL_ADDR A:0x60086000
y.create.l HWIO_PCIE_0_QSERDES_COM_PLL_VCOTAIL_EN_ADDR A:0x60086004
y.create.l HWIO_PCIE_0_QSERDES_COM_CMN_MODE_ADDR A:0x60086008
y.create.l HWIO_PCIE_0_QSERDES_COM_IE_TRIM_ADDR A:0x6008600c
y.create.l HWIO_PCIE_0_QSERDES_COM_IP_TRIM_ADDR A:0x60086010
y.create.l HWIO_PCIE_0_QSERDES_COM_PLL_CNTRL_ADDR A:0x60086014
y.create.l HWIO_PCIE_0_QSERDES_COM_PLL_PHSEL_CONTROL_ADDR A:0x60086018
y.create.l HWIO_PCIE_0_QSERDES_COM_IPTAT_TRIM_VCCA_TX_SEL_ADDR A:0x6008601c
y.create.l HWIO_PCIE_0_QSERDES_COM_PLL_PHSEL_DC_ADDR A:0x60086020
y.create.l HWIO_PCIE_0_QSERDES_COM_PLL_IP_SETI_ADDR A:0x60086024
y.create.l HWIO_PCIE_0_QSERDES_COM_CORE_CLK_IN_SYNC_SEL_ADDR A:0x60086028
y.create.l HWIO_PCIE_0_QSERDES_COM_PLL_BKG_KVCO_CAL_EN_ADDR A:0x6008602c
y.create.l HWIO_PCIE_0_QSERDES_COM_BIAS_EN_CLKBUFLR_EN_ADDR A:0x60086030
y.create.l HWIO_PCIE_0_QSERDES_COM_PLL_CP_SETI_ADDR A:0x60086034
y.create.l HWIO_PCIE_0_QSERDES_COM_PLL_IP_SETP_ADDR A:0x60086038
y.create.l HWIO_PCIE_0_QSERDES_COM_PLL_CP_SETP_ADDR A:0x6008603c
y.create.l HWIO_PCIE_0_QSERDES_COM_ATB_SEL1_ADDR A:0x60086040
y.create.l HWIO_PCIE_0_QSERDES_COM_ATB_SEL2_ADDR A:0x60086044
y.create.l HWIO_PCIE_0_QSERDES_COM_SYSCLK_EN_SEL_TXBAND_ADDR A:0x60086048
y.create.l HWIO_PCIE_0_QSERDES_COM_RESETSM_CNTRL_ADDR A:0x6008604c
y.create.l HWIO_PCIE_0_QSERDES_COM_RESETSM_CNTRL2_ADDR A:0x60086050
y.create.l HWIO_PCIE_0_QSERDES_COM_RESETSM_CNTRL3_ADDR A:0x60086054
y.create.l HWIO_PCIE_0_QSERDES_COM_RESETSM_PLL_CAL_COUNT1_ADDR A:0x60086058
y.create.l HWIO_PCIE_0_QSERDES_COM_RESETSM_PLL_CAL_COUNT2_ADDR A:0x6008605c
y.create.l HWIO_PCIE_0_QSERDES_COM_DIV_REF1_ADDR A:0x60086060
y.create.l HWIO_PCIE_0_QSERDES_COM_DIV_REF2_ADDR A:0x60086064
y.create.l HWIO_PCIE_0_QSERDES_COM_KVCO_COUNT1_ADDR A:0x60086068
y.create.l HWIO_PCIE_0_QSERDES_COM_KVCO_COUNT2_ADDR A:0x6008606c
y.create.l HWIO_PCIE_0_QSERDES_COM_KVCO_CAL_CNTRL_ADDR A:0x60086070
y.create.l HWIO_PCIE_0_QSERDES_COM_KVCO_CODE_ADDR A:0x60086074
y.create.l HWIO_PCIE_0_QSERDES_COM_VREF_CFG1_ADDR A:0x60086078
y.create.l HWIO_PCIE_0_QSERDES_COM_VREF_CFG2_ADDR A:0x6008607c
y.create.l HWIO_PCIE_0_QSERDES_COM_VREF_CFG3_ADDR A:0x60086080
y.create.l HWIO_PCIE_0_QSERDES_COM_VREF_CFG4_ADDR A:0x60086084
y.create.l HWIO_PCIE_0_QSERDES_COM_VREF_CFG5_ADDR A:0x60086088
y.create.l HWIO_PCIE_0_QSERDES_COM_VREF_CFG6_ADDR A:0x6008608c
y.create.l HWIO_PCIE_0_QSERDES_COM_PLLLOCK_CMP1_ADDR A:0x60086090
y.create.l HWIO_PCIE_0_QSERDES_COM_PLLLOCK_CMP2_ADDR A:0x60086094
y.create.l HWIO_PCIE_0_QSERDES_COM_PLLLOCK_CMP3_ADDR A:0x60086098
y.create.l HWIO_PCIE_0_QSERDES_COM_PLLLOCK_CMP_EN_ADDR A:0x6008609c
y.create.l HWIO_PCIE_0_QSERDES_COM_BGTC_ADDR A:0x600860a0
y.create.l HWIO_PCIE_0_QSERDES_COM_PLL_TEST_UPDN_ADDR A:0x600860a4
y.create.l HWIO_PCIE_0_QSERDES_COM_PLL_VCO_TUNE_ADDR A:0x600860a8
y.create.l HWIO_PCIE_0_QSERDES_COM_DEC_START1_ADDR A:0x600860ac
y.create.l HWIO_PCIE_0_QSERDES_COM_PLL_AMP_OS_ADDR A:0x600860b0
y.create.l HWIO_PCIE_0_QSERDES_COM_SSC_EN_CENTER_ADDR A:0x600860b4
y.create.l HWIO_PCIE_0_QSERDES_COM_SSC_ADJ_PER1_ADDR A:0x600860b8
y.create.l HWIO_PCIE_0_QSERDES_COM_SSC_ADJ_PER2_ADDR A:0x600860bc
y.create.l HWIO_PCIE_0_QSERDES_COM_SSC_PER1_ADDR A:0x600860c0
y.create.l HWIO_PCIE_0_QSERDES_COM_SSC_PER2_ADDR A:0x600860c4
y.create.l HWIO_PCIE_0_QSERDES_COM_SSC_STEP_SIZE1_ADDR A:0x600860c8
y.create.l HWIO_PCIE_0_QSERDES_COM_SSC_STEP_SIZE2_ADDR A:0x600860cc
y.create.l HWIO_PCIE_0_QSERDES_COM_RES_CODE_UP_ADDR A:0x600860d0
y.create.l HWIO_PCIE_0_QSERDES_COM_RES_CODE_DN_ADDR A:0x600860d4
y.create.l HWIO_PCIE_0_QSERDES_COM_RES_CODE_UP_OFFSET_ADDR A:0x600860d8
y.create.l HWIO_PCIE_0_QSERDES_COM_RES_CODE_DN_OFFSET_ADDR A:0x600860dc
y.create.l HWIO_PCIE_0_QSERDES_COM_RES_CODE_START_SEG1_ADDR A:0x600860e0
y.create.l HWIO_PCIE_0_QSERDES_COM_RES_CODE_START_SEG2_ADDR A:0x600860e4
y.create.l HWIO_PCIE_0_QSERDES_COM_RES_CODE_CAL_CSR_ADDR A:0x600860e8
y.create.l HWIO_PCIE_0_QSERDES_COM_RES_CODE_ADDR A:0x600860ec
y.create.l HWIO_PCIE_0_QSERDES_COM_RES_TRIM_CONTROL_ADDR A:0x600860f0
y.create.l HWIO_PCIE_0_QSERDES_COM_RES_TRIM_CONTROL2_ADDR A:0x600860f4
y.create.l HWIO_PCIE_0_QSERDES_COM_RES_TRIM_EN_VCOCALDONE_ADDR A:0x600860f8
y.create.l HWIO_PCIE_0_QSERDES_COM_FAUX_EN_ADDR A:0x600860fc
y.create.l HWIO_PCIE_0_QSERDES_COM_DIV_FRAC_START1_ADDR A:0x60086100
y.create.l HWIO_PCIE_0_QSERDES_COM_DIV_FRAC_START2_ADDR A:0x60086104
y.create.l HWIO_PCIE_0_QSERDES_COM_DIV_FRAC_START3_ADDR A:0x60086108
y.create.l HWIO_PCIE_0_QSERDES_COM_DEC_START2_ADDR A:0x6008610c
y.create.l HWIO_PCIE_0_QSERDES_COM_PLL_RXTXEPCLK_EN_ADDR A:0x60086110
y.create.l HWIO_PCIE_0_QSERDES_COM_PLL_CRCTRL_ADDR A:0x60086114
y.create.l HWIO_PCIE_0_QSERDES_COM_PLL_CLKEPDIV_ADDR A:0x60086118
y.create.l HWIO_PCIE_0_QSERDES_COM_PLL_FREQUPDATE_ADDR A:0x6008611c
y.create.l HWIO_PCIE_0_QSERDES_COM_PLL_BKGCAL_TRIM_UP_ADDR A:0x60086120
y.create.l HWIO_PCIE_0_QSERDES_COM_PLL_BKGCAL_TRIM_DN_ADDR A:0x60086124
y.create.l HWIO_PCIE_0_QSERDES_COM_PLL_BKGCAL_TRIM_MUX_ADDR A:0x60086128
y.create.l HWIO_PCIE_0_QSERDES_COM_PLL_BKGCAL_VREF_CFG_ADDR A:0x6008612c
y.create.l HWIO_PCIE_0_QSERDES_COM_PLL_BKGCAL_DIV_REF1_ADDR A:0x60086130
y.create.l HWIO_PCIE_0_QSERDES_COM_PLL_BKGCAL_DIV_REF2_ADDR A:0x60086134
y.create.l HWIO_PCIE_0_QSERDES_COM_MUXADDR_ADDR A:0x60086138
y.create.l HWIO_PCIE_0_QSERDES_COM_LOW_POWER_RO_CONTROL_ADDR A:0x6008613c
y.create.l HWIO_PCIE_0_QSERDES_COM_POST_DIVIDER_CONTROL_ADDR A:0x60086140
y.create.l HWIO_PCIE_0_QSERDES_COM_HR_OCLK2_DIVIDER_ADDR A:0x60086144
y.create.l HWIO_PCIE_0_QSERDES_COM_HR_OCLK3_DIVIDER_ADDR A:0x60086148
y.create.l HWIO_PCIE_0_QSERDES_COM_PLL_VCO_HIGH_ADDR A:0x6008614c
y.create.l HWIO_PCIE_0_QSERDES_COM_RESET_SM_ADDR A:0x60086150
y.create.l HWIO_PCIE_0_QSERDES_COM_MUXVAL_ADDR A:0x60086154
y.create.l HWIO_PCIE_0_QSERDES_COM_CORE_RES_CODE_DN_ADDR A:0x60086158
y.create.l HWIO_PCIE_0_QSERDES_COM_CORE_RES_CODE_UP_ADDR A:0x6008615c
y.create.l HWIO_PCIE_0_QSERDES_COM_CORE_VCO_TUNE_ADDR A:0x60086160
y.create.l HWIO_PCIE_0_QSERDES_COM_CORE_VCO_TAIL_ADDR A:0x60086164
y.create.l HWIO_PCIE_0_QSERDES_COM_CORE_KVCO_CODE_ADDR A:0x60086168
y.create.l HWIO_PCIE_0_QSERDES_TX_BIST_MODE_LANENO_ADDR A:0x60086200
y.create.l HWIO_PCIE_0_QSERDES_TX_CLKBUF_ENABLE_ADDR A:0x60086204
y.create.l HWIO_PCIE_0_QSERDES_TX_TX_EMP_POST1_LVL_ADDR A:0x60086208
y.create.l HWIO_PCIE_0_QSERDES_TX_TX_DRV_LVL_ADDR A:0x6008620c
y.create.l HWIO_PCIE_0_QSERDES_TX_RESET_TSYNC_EN_ADDR A:0x60086210
y.create.l HWIO_PCIE_0_QSERDES_TX_LPB_EN_ADDR A:0x60086214
y.create.l HWIO_PCIE_0_QSERDES_TX_RES_CODE_UP_ADDR A:0x60086218
y.create.l HWIO_PCIE_0_QSERDES_TX_RES_CODE_DN_ADDR A:0x6008621c
y.create.l HWIO_PCIE_0_QSERDES_TX_PERL_LENGTH1_ADDR A:0x60086220
y.create.l HWIO_PCIE_0_QSERDES_TX_PERL_LENGTH2_ADDR A:0x60086224
y.create.l HWIO_PCIE_0_QSERDES_TX_SERDES_BYP_EN_OUT_ADDR A:0x60086228
y.create.l HWIO_PCIE_0_QSERDES_TX_HIGHZ_TRANSCEIVEREN_BIAS_DRVR_EN_ADDR A:0x6008622c
y.create.l HWIO_PCIE_0_QSERDES_TX_PARRATE_REC_DETECT_IDLE_EN_ADDR A:0x60086230
y.create.l HWIO_PCIE_0_QSERDES_TX_BIST_PATTERN1_ADDR A:0x60086234
y.create.l HWIO_PCIE_0_QSERDES_TX_BIST_PATTERN2_ADDR A:0x60086238
y.create.l HWIO_PCIE_0_QSERDES_TX_BIST_PATTERN3_ADDR A:0x6008623c
y.create.l HWIO_PCIE_0_QSERDES_TX_BIST_PATTERN4_ADDR A:0x60086240
y.create.l HWIO_PCIE_0_QSERDES_TX_BIST_PATTERN5_ADDR A:0x60086244
y.create.l HWIO_PCIE_0_QSERDES_TX_BIST_PATTERN6_ADDR A:0x60086248
y.create.l HWIO_PCIE_0_QSERDES_TX_BIST_PATTERN7_ADDR A:0x6008624c
y.create.l HWIO_PCIE_0_QSERDES_TX_BIST_PATTERN8_ADDR A:0x60086250
y.create.l HWIO_PCIE_0_QSERDES_TX_LANE_MODE_ADDR A:0x60086254
y.create.l HWIO_PCIE_0_QSERDES_TX_IDAC_CAL_LANE_MODE_ADDR A:0x60086258
y.create.l HWIO_PCIE_0_QSERDES_TX_IDAC_CAL_LANE_MODE_CONFIGURATION_ADDR A:0x6008625c
y.create.l HWIO_PCIE_0_QSERDES_TX_ATB_SEL1_ADDR A:0x60086260
y.create.l HWIO_PCIE_0_QSERDES_TX_ATB_SEL2_ADDR A:0x60086264
y.create.l HWIO_PCIE_0_QSERDES_TX_RCV_DETECT_LVL_ADDR A:0x60086268
y.create.l HWIO_PCIE_0_QSERDES_TX_PRBS_SEED1_ADDR A:0x6008626c
y.create.l HWIO_PCIE_0_QSERDES_TX_PRBS_SEED2_ADDR A:0x60086270
y.create.l HWIO_PCIE_0_QSERDES_TX_PRBS_SEED3_ADDR A:0x60086274
y.create.l HWIO_PCIE_0_QSERDES_TX_PRBS_SEED4_ADDR A:0x60086278
y.create.l HWIO_PCIE_0_QSERDES_TX_RESET_GEN_ADDR A:0x6008627c
y.create.l HWIO_PCIE_0_QSERDES_TX_TRAN_DRVR_EMP_EN_ADDR A:0x60086280
y.create.l HWIO_PCIE_0_QSERDES_TX_TX_INTERFACE_MODE_ADDR A:0x60086284
y.create.l HWIO_PCIE_0_QSERDES_TX_PWM_CTRL_ADDR A:0x60086288
y.create.l HWIO_PCIE_0_QSERDES_TX_PWM_DATA_ADDR A:0x6008628c
y.create.l HWIO_PCIE_0_QSERDES_TX_PWM_ENC_DIV_CTRL_ADDR A:0x60086290
y.create.l HWIO_PCIE_0_QSERDES_TX_VMODE_CTRL1_ADDR A:0x60086294
y.create.l HWIO_PCIE_0_QSERDES_TX_VMODE_CTRL2_ADDR A:0x60086298
y.create.l HWIO_PCIE_0_QSERDES_TX_VMODE_CTRL3_ADDR A:0x6008629c
y.create.l HWIO_PCIE_0_QSERDES_TX_VMODE_CTRL4_ADDR A:0x600862a0
y.create.l HWIO_PCIE_0_QSERDES_TX_VMODE_CTRL5_ADDR A:0x600862a4
y.create.l HWIO_PCIE_0_QSERDES_TX_VMODE_CTRL6_ADDR A:0x600862a8
y.create.l HWIO_PCIE_0_QSERDES_TX_VMODE_CTRL7_ADDR A:0x600862ac
y.create.l HWIO_PCIE_0_QSERDES_TX_TX_ALOG_INTF_OBSV_CNTL_ADDR A:0x600862b0
y.create.l HWIO_PCIE_0_QSERDES_TX_BIST_STATUS_ADDR A:0x600862b4
y.create.l HWIO_PCIE_0_QSERDES_TX_BIST_ERROR_COUNT1_ADDR A:0x600862b8
y.create.l HWIO_PCIE_0_QSERDES_TX_BIST_ERROR_COUNT2_ADDR A:0x600862bc
y.create.l HWIO_PCIE_0_QSERDES_TX_TX_ALOG_INTF_OBSV_ADDR A:0x600862c0
y.create.l HWIO_PCIE_0_QSERDES_TX_PWM_DEC_STATUS_ADDR A:0x600862c4
y.create.l HWIO_PCIE_0_QSERDES_RX_CDR_CONTROL1_ADDR A:0x60086400
y.create.l HWIO_PCIE_0_QSERDES_RX_CDR_CONTROL2_ADDR A:0x60086404
y.create.l HWIO_PCIE_0_QSERDES_RX_CDR_CONTROL_HALF_ADDR A:0x60086408
y.create.l HWIO_PCIE_0_QSERDES_RX_CDR_CONTROL_QUARTER_ADDR A:0x6008640c
y.create.l HWIO_PCIE_0_QSERDES_RX_CDR_CONTROL_EIGHTH_ADDR A:0x60086410
y.create.l HWIO_PCIE_0_QSERDES_RX_UCDR_FO_GAIN_ADDR A:0x60086414
y.create.l HWIO_PCIE_0_QSERDES_RX_UCDR_SO_GAIN_ADDR A:0x60086418
y.create.l HWIO_PCIE_0_QSERDES_RX_UCDR_SO_SATURATION_AND_ENABLE_ADDR A:0x6008641c
y.create.l HWIO_PCIE_0_QSERDES_RX_UCDR_FO_TO_SO_DELAY_ADDR A:0x60086420
y.create.l HWIO_PCIE_0_QSERDES_RX_AUX_CONTROL_ADDR A:0x60086424
y.create.l HWIO_PCIE_0_QSERDES_RX_AUX_DATA_TCOARSE_ADDR A:0x60086428
y.create.l HWIO_PCIE_0_QSERDES_RX_AUX_DATA_TFINE_LSB_ADDR A:0x6008642c
y.create.l HWIO_PCIE_0_QSERDES_RX_AUX_DATA_TFINE_MSB_ADDR A:0x60086430
y.create.l HWIO_PCIE_0_QSERDES_RX_RCLK_AUXDATA_SEL_ADDR A:0x60086434
y.create.l HWIO_PCIE_0_QSERDES_RX_AC_JTAG_ENABLE_ADDR A:0x60086438
y.create.l HWIO_PCIE_0_QSERDES_RX_AC_JTAG_INITP_ADDR A:0x6008643c
y.create.l HWIO_PCIE_0_QSERDES_RX_AC_JTAG_INITN_ADDR A:0x60086440
y.create.l HWIO_PCIE_0_QSERDES_RX_AC_JTAG_LVL_ADDR A:0x60086444
y.create.l HWIO_PCIE_0_QSERDES_RX_AC_JTAG_MODE_ADDR A:0x60086448
y.create.l HWIO_PCIE_0_QSERDES_RX_AC_JTAG_RESET_ADDR A:0x6008644c
y.create.l HWIO_PCIE_0_QSERDES_RX_RX_RCVR_IQ_EN_ADDR A:0x60086450
y.create.l HWIO_PCIE_0_QSERDES_RX_RX_IDAC_I_DC_OFFSETS_ADDR A:0x60086454
y.create.l HWIO_PCIE_0_QSERDES_RX_RX_IDAC_Q_DC_OFFSETS_ADDR A:0x60086458
y.create.l HWIO_PCIE_0_QSERDES_RX_RX_IDAC_A_DC_OFFSETS_ADDR A:0x6008645c
y.create.l HWIO_PCIE_0_QSERDES_RX_RX_IDAC_EN_ADDR A:0x60086460
y.create.l HWIO_PCIE_0_QSERDES_RX_RX_IDAC_CTRL0_ADDR A:0x60086464
y.create.l HWIO_PCIE_0_QSERDES_RX_RX_IDAC_CTRL1_ADDR A:0x60086468
y.create.l HWIO_PCIE_0_QSERDES_RX_RX_EOM_EN_ADDR A:0x6008646c
y.create.l HWIO_PCIE_0_QSERDES_RX_RX_EOM_CTRL0_ADDR A:0x60086470
y.create.l HWIO_PCIE_0_QSERDES_RX_RX_EOM_CTRL1_ADDR A:0x60086474
y.create.l HWIO_PCIE_0_QSERDES_RX_RX_EOM_CTRL2_ADDR A:0x60086478
y.create.l HWIO_PCIE_0_QSERDES_RX_RX_EOM_CTRL3_ADDR A:0x6008647c
y.create.l HWIO_PCIE_0_QSERDES_RX_RX_EOM_CTRL4_ADDR A:0x60086480
y.create.l HWIO_PCIE_0_QSERDES_RX_RX_EOM_CTRL5_ADDR A:0x60086484
y.create.l HWIO_PCIE_0_QSERDES_RX_RX_EOM_CTRL6_ADDR A:0x60086488
y.create.l HWIO_PCIE_0_QSERDES_RX_RX_EOM_CTRL7_ADDR A:0x6008648c
y.create.l HWIO_PCIE_0_QSERDES_RX_RX_EOM_CTRL8_ADDR A:0x60086490
y.create.l HWIO_PCIE_0_QSERDES_RX_RX_EOM_CTRL9_ADDR A:0x60086494
y.create.l HWIO_PCIE_0_QSERDES_RX_RX_EOM_CTRL10_ADDR A:0x60086498
y.create.l HWIO_PCIE_0_QSERDES_RX_RX_EOM_CTRL11_ADDR A:0x6008649c
y.create.l HWIO_PCIE_0_QSERDES_RX_RX_HIGHZ_HIGHRATE_ADDR A:0x600864a0
y.create.l HWIO_PCIE_0_QSERDES_RX_RX_TERM_AC_BYPASS_DC_COUPLE_OFFSET_ADDR A:0x600864a4
y.create.l HWIO_PCIE_0_QSERDES_RX_RX_EQ_GAIN1_LSB_ADDR A:0x600864a8
y.create.l HWIO_PCIE_0_QSERDES_RX_RX_EQ_GAIN1_MSB_ADDR A:0x600864ac
y.create.l HWIO_PCIE_0_QSERDES_RX_RX_EQ_GAIN2_LSB_ADDR A:0x600864b0
y.create.l HWIO_PCIE_0_QSERDES_RX_RX_EQ_GAIN2_MSB_ADDR A:0x600864b4
y.create.l HWIO_PCIE_0_QSERDES_RX_RX_EQU_ADAPTOR_CNTRL1_ADDR A:0x600864b8
y.create.l HWIO_PCIE_0_QSERDES_RX_RX_EQU_ADAPTOR_CNTRL2_ADDR A:0x600864bc
y.create.l HWIO_PCIE_0_QSERDES_RX_RX_EQU_ADAPTOR_CNTRL3_ADDR A:0x600864c0
y.create.l HWIO_PCIE_0_QSERDES_RX_RX_EQU_ADAPTOR_CNTRL4_ADDR A:0x600864c4
y.create.l HWIO_PCIE_0_QSERDES_RX_RX_IDAC_CAL_CONFIGURATION_ADDR A:0x600864c8
y.create.l HWIO_PCIE_0_QSERDES_RX_RX_IDAC_CAL_CONFIGURATION_2_ADDR A:0x600864cc
y.create.l HWIO_PCIE_0_QSERDES_RX_RX_IDAC_TSETTLE_LOW_ADDR A:0x600864d0
y.create.l HWIO_PCIE_0_QSERDES_RX_RX_IDAC_TSETTLE_HIGH_ADDR A:0x600864d4
y.create.l HWIO_PCIE_0_QSERDES_RX_RX_IDAC_ENDSAMP_LOW_ADDR A:0x600864d8
y.create.l HWIO_PCIE_0_QSERDES_RX_RX_IDAC_ENDSAMP_HIGH_ADDR A:0x600864dc
y.create.l HWIO_PCIE_0_QSERDES_RX_RX_IDAC_MIDPOINT_LOW_ADDR A:0x600864e0
y.create.l HWIO_PCIE_0_QSERDES_RX_RX_IDAC_MIDPOINT_HIGH_ADDR A:0x600864e4
y.create.l HWIO_PCIE_0_QSERDES_RX_RX_EQ_OFFSET_LSB_ADDR A:0x600864e8
y.create.l HWIO_PCIE_0_QSERDES_RX_RX_EQ_OFFSET_MSB_ADDR A:0x600864ec
y.create.l HWIO_PCIE_0_QSERDES_RX_RX_EQ_OFFSET_ADAPTOR_CNTRL1_ADDR A:0x600864f0
y.create.l HWIO_PCIE_0_QSERDES_RX_RX_OFFSET_ADAPTOR_CNTRL2_ADDR A:0x600864f4
y.create.l HWIO_PCIE_0_QSERDES_RX_SIGDET_ENABLES_ADDR A:0x600864f8
y.create.l HWIO_PCIE_0_QSERDES_RX_SIGDET_ENABLES_2_ADDR A:0x600864fc
y.create.l HWIO_PCIE_0_QSERDES_RX_SIGDET_CNTRL_ADDR A:0x60086500
y.create.l HWIO_PCIE_0_QSERDES_RX_SIGDET_DEGLITCH_CNTRL_ADDR A:0x60086504
y.create.l HWIO_PCIE_0_QSERDES_RX_SIGDET_TIMER_LIMIT_ADDR A:0x60086508
y.create.l HWIO_PCIE_0_QSERDES_RX_RX_BAND_ADDR A:0x6008650c
y.create.l HWIO_PCIE_0_QSERDES_RX_CDR_FREEZE_UP_DN_ADDR A:0x60086510
y.create.l HWIO_PCIE_0_QSERDES_RX_RX_INTERFACE_MODE_ADDR A:0x60086514
y.create.l HWIO_PCIE_0_QSERDES_RX_JITTER_GEN_MODE_ADDR A:0x60086518
y.create.l HWIO_PCIE_0_QSERDES_RX_BUJ_AMP_ADDR A:0x6008651c
y.create.l HWIO_PCIE_0_QSERDES_RX_SJ_AMP1_ADDR A:0x60086520
y.create.l HWIO_PCIE_0_QSERDES_RX_SJ_AMP2_ADDR A:0x60086524
y.create.l HWIO_PCIE_0_QSERDES_RX_SJ_PER1_ADDR A:0x60086528
y.create.l HWIO_PCIE_0_QSERDES_RX_SJ_PER2_ADDR A:0x6008652c
y.create.l HWIO_PCIE_0_QSERDES_RX_BUJ_STEP_FREQ1_ADDR A:0x60086530
y.create.l HWIO_PCIE_0_QSERDES_RX_BUJ_STEP_FREQ2_ADDR A:0x60086534
y.create.l HWIO_PCIE_0_QSERDES_RX_PPM_OFFSET1_ADDR A:0x60086538
y.create.l HWIO_PCIE_0_QSERDES_RX_PPM_OFFSET2_ADDR A:0x6008653c
y.create.l HWIO_PCIE_0_QSERDES_RX_SIGN_PPM_PERIOD1_ADDR A:0x60086540
y.create.l HWIO_PCIE_0_QSERDES_RX_SIGN_PPM_PERIOD2_ADDR A:0x60086544
y.create.l HWIO_PCIE_0_QSERDES_RX_SSC_CTRL_ADDR A:0x60086548
y.create.l HWIO_PCIE_0_QSERDES_RX_SSC_COUNT1_ADDR A:0x6008654c
y.create.l HWIO_PCIE_0_QSERDES_RX_SSC_COUNT2_ADDR A:0x60086550
y.create.l HWIO_PCIE_0_QSERDES_RX_RX_ALOG_INTF_OBSV_CNTL_ADDR A:0x60086554
y.create.l HWIO_PCIE_0_QSERDES_RX_PI_CTRL1_ADDR A:0x60086558
y.create.l HWIO_PCIE_0_QSERDES_RX_PI_CTRL2_ADDR A:0x6008655c
y.create.l HWIO_PCIE_0_QSERDES_RX_PI_QUAD_ADDR A:0x60086560
y.create.l HWIO_PCIE_0_QSERDES_RX_IDATA1_ADDR A:0x60086564
y.create.l HWIO_PCIE_0_QSERDES_RX_IDATA2_ADDR A:0x60086568
y.create.l HWIO_PCIE_0_QSERDES_RX_AUX_DATA1_ADDR A:0x6008656c
y.create.l HWIO_PCIE_0_QSERDES_RX_AUX_DATA2_ADDR A:0x60086570
y.create.l HWIO_PCIE_0_QSERDES_RX_AC_JTAG_OUTP_ADDR A:0x60086574
y.create.l HWIO_PCIE_0_QSERDES_RX_AC_JTAG_OUTN_ADDR A:0x60086578
y.create.l HWIO_PCIE_0_QSERDES_RX_RX_SIGDET_ADDR A:0x6008657c
y.create.l HWIO_PCIE_0_QSERDES_RX_RX_VDCOFF_ADDR A:0x60086580
y.create.l HWIO_PCIE_0_QSERDES_RX_IDAC_CAL_ON_ADDR A:0x60086584
y.create.l HWIO_PCIE_0_QSERDES_RX_IDAC_STATUS_I_ADDR A:0x60086588
y.create.l HWIO_PCIE_0_QSERDES_RX_IDAC_STATUS_Q_ADDR A:0x6008658c
y.create.l HWIO_PCIE_0_QSERDES_RX_IDAC_STATUS_A_ADDR A:0x60086590
y.create.l HWIO_PCIE_0_QSERDES_RX_CALST_STATUS_I_ADDR A:0x60086594
y.create.l HWIO_PCIE_0_QSERDES_RX_CALST_STATUS_Q_ADDR A:0x60086598
y.create.l HWIO_PCIE_0_QSERDES_RX_CALST_STATUS_A_ADDR A:0x6008659c
y.create.l HWIO_PCIE_0_QSERDES_RX_EOM_STATUS0_ADDR A:0x600865a0
y.create.l HWIO_PCIE_0_QSERDES_RX_EOM_STATUS1_ADDR A:0x600865a4
y.create.l HWIO_PCIE_0_QSERDES_RX_EOM_STATUS2_ADDR A:0x600865a8
y.create.l HWIO_PCIE_0_QSERDES_RX_EOM_STATUS3_ADDR A:0x600865ac
y.create.l HWIO_PCIE_0_QSERDES_RX_EOM_STATUS4_ADDR A:0x600865b0
y.create.l HWIO_PCIE_0_QSERDES_RX_EOM_STATUS5_ADDR A:0x600865b4
y.create.l HWIO_PCIE_0_QSERDES_RX_EOM_STATUS6_ADDR A:0x600865b8
y.create.l HWIO_PCIE_0_QSERDES_RX_EOM_STATUS7_ADDR A:0x600865bc
y.create.l HWIO_PCIE_0_QSERDES_RX_EOM_STATUS8_ADDR A:0x600865c0
y.create.l HWIO_PCIE_0_QSERDES_RX_EOM_STATUS9_ADDR A:0x600865c4
y.create.l HWIO_PCIE_0_QSERDES_RX_RX_ALOG_INTF_OBSV_ADDR A:0x600865c8
y.create.l HWIO_PCIE_0_QSERDES_RX_READ_EQCODE_ADDR A:0x600865cc
y.create.l HWIO_PCIE_0_QSERDES_RX_READ_OFFSETCODE_ADDR A:0x600865d0
y.create.l HWIO_PCIE_0_PCIE_USB3_PHY_SW_RESET_ADDR A:0x60086600
y.create.l HWIO_PCIE_0_PCIE_USB3_PHY_POWER_DOWN_CONTROL_ADDR A:0x60086604
y.create.l HWIO_PCIE_0_PCIE_USB3_PHY_START_ADDR A:0x60086608
y.create.l HWIO_PCIE_0_PCIE_USB3_PHY_TXMGN_V1_V0_ADDR A:0x6008660c
y.create.l HWIO_PCIE_0_PCIE_USB3_PHY_TXMGN_V3_V2_ADDR A:0x60086610
y.create.l HWIO_PCIE_0_PCIE_USB3_PHY_TXMGN_LS_V4_ADDR A:0x60086614
y.create.l HWIO_PCIE_0_PCIE_USB3_PHY_TXDEEMPH_M6DB_V0_ADDR A:0x60086618
y.create.l HWIO_PCIE_0_PCIE_USB3_PHY_TXDEEMPH_M3P5DB_V0_ADDR A:0x6008661c
y.create.l HWIO_PCIE_0_PCIE_USB3_PHY_TXDEEMPH_M6DB_V1_ADDR A:0x60086620
y.create.l HWIO_PCIE_0_PCIE_USB3_PHY_TXDEEMPH_M3P5DB_V1_ADDR A:0x60086624
y.create.l HWIO_PCIE_0_PCIE_USB3_PHY_TXDEEMPH_M6DB_V2_ADDR A:0x60086628
y.create.l HWIO_PCIE_0_PCIE_USB3_PHY_TXDEEMPH_M3P5DB_V2_ADDR A:0x6008662c
y.create.l HWIO_PCIE_0_PCIE_USB3_PHY_TXDEEMPH_M6DB_V3_ADDR A:0x60086630
y.create.l HWIO_PCIE_0_PCIE_USB3_PHY_TXDEEMPH_M3P5DB_V3_ADDR A:0x60086634
y.create.l HWIO_PCIE_0_PCIE_USB3_PHY_TXDEEMPH_M6DB_V4_ADDR A:0x60086638
y.create.l HWIO_PCIE_0_PCIE_USB3_PHY_TXDEEMPH_M3P5DB_V4_ADDR A:0x6008663c
y.create.l HWIO_PCIE_0_PCIE_USB3_PHY_TXDEEMPH_M6DB_LS_ADDR A:0x60086640
y.create.l HWIO_PCIE_0_PCIE_USB3_PHY_TXDEEMPH_M3P5DB_LS_ADDR A:0x60086644
y.create.l HWIO_PCIE_0_PCIE_USB3_PHY_ENDPOINT_REFCLK_DRIVE_ADDR A:0x60086648
y.create.l HWIO_PCIE_0_PCIE_USB3_PHY_RX_IDLE_DTCT_CNTRL_ADDR A:0x6008664c
y.create.l HWIO_PCIE_0_PCIE_USB3_PHY_POWER_STATE_CONFIG1_ADDR A:0x60086650
y.create.l HWIO_PCIE_0_PCIE_USB3_PHY_POWER_STATE_CONFIG2_ADDR A:0x60086654
y.create.l HWIO_PCIE_0_PCIE_USB3_PHY_POWER_STATE_CONFIG3_ADDR A:0x60086658
y.create.l HWIO_PCIE_0_PCIE_USB3_PHY_RCVR_DTCT_DLY_P1U2_L_ADDR A:0x6008665c
y.create.l HWIO_PCIE_0_PCIE_USB3_PHY_RCVR_DTCT_DLY_P1U2_H_ADDR A:0x60086660
y.create.l HWIO_PCIE_0_PCIE_USB3_PHY_RCVR_DTCT_DLY_U3_L_ADDR A:0x60086664
y.create.l HWIO_PCIE_0_PCIE_USB3_PHY_RCVR_DTCT_DLY_U3_H_ADDR A:0x60086668
y.create.l HWIO_PCIE_0_PCIE_USB3_PHY_LOCK_DETECT_CONFIG1_ADDR A:0x6008666c
y.create.l HWIO_PCIE_0_PCIE_USB3_PHY_LOCK_DETECT_CONFIG2_ADDR A:0x60086670
y.create.l HWIO_PCIE_0_PCIE_USB3_PHY_LOCK_DETECT_CONFIG3_ADDR A:0x60086674
y.create.l HWIO_PCIE_0_PCIE_USB3_PHY_TSYNC_RSYNC_TIME_ADDR A:0x60086678
y.create.l HWIO_PCIE_0_PCIE_USB3_PHY_SIGDET_LOW_2_IDLE_TIME_ADDR A:0x6008667c
y.create.l HWIO_PCIE_0_PCIE_USB3_PHY_BEACON_2_IDLE_TIME_L_ADDR A:0x60086680
y.create.l HWIO_PCIE_0_PCIE_USB3_PHY_BEACON_2_IDLE_TIME_H_ADDR A:0x60086684
y.create.l HWIO_PCIE_0_PCIE_USB3_PHY_PWRUP_RESET_DLY_TIME_SYSCLK_ADDR A:0x60086688
y.create.l HWIO_PCIE_0_PCIE_USB3_PHY_PWRUP_RESET_DLY_TIME_AUXCLK_ADDR A:0x6008668c
y.create.l HWIO_PCIE_0_PCIE_USB3_PHY_LFPS_DET_HIGH_COUNT_VAL_ADDR A:0x60086690
y.create.l HWIO_PCIE_0_PCIE_USB3_PHY_LFPS_TX_ECSTART_EQTLOCK_ADDR A:0x60086694
y.create.l HWIO_PCIE_0_PCIE_USB3_PHY_LFPS_TX_END_CNT_P2U3_START_ADDR A:0x60086698
y.create.l HWIO_PCIE_0_PCIE_USB3_PHY_RXEQTRAINING_WAIT_TIME_ADDR A:0x6008669c
y.create.l HWIO_PCIE_0_PCIE_USB3_PHY_RXEQTRAINING_RUN_TIME_ADDR A:0x600866a0
y.create.l HWIO_PCIE_0_PCIE_USB3_PHY_TXONESZEROS_RUN_LENGTH_ADDR A:0x600866a4
y.create.l HWIO_PCIE_0_PCIE_USB3_PHY_FLL_CNTRL1_ADDR A:0x600866a8
y.create.l HWIO_PCIE_0_PCIE_USB3_PHY_FLL_CNTRL2_ADDR A:0x600866ac
y.create.l HWIO_PCIE_0_PCIE_USB3_PHY_FLL_CNT_VAL_L_ADDR A:0x600866b0
y.create.l HWIO_PCIE_0_PCIE_USB3_PHY_FLL_CNT_VAL_H_TOL_ADDR A:0x600866b4
y.create.l HWIO_PCIE_0_PCIE_USB3_PHY_FLL_MAN_CODE_ADDR A:0x600866b8
y.create.l HWIO_PCIE_0_PCIE_USB3_PHY_AUTONOMOUS_MODE_CTRL_ADDR A:0x600866bc
y.create.l HWIO_PCIE_0_PCIE_USB3_PHY_LFPS_RXTERM_IRQ_CLEAR_ADDR A:0x600866c0
y.create.l HWIO_PCIE_0_PCIE_USB3_PHY_ARCVR_DTCT_EN_PERIOD_ADDR A:0x600866c4
y.create.l HWIO_PCIE_0_PCIE_USB3_PHY_ARCVR_DTCT_CM_DLY_ADDR A:0x600866c8
y.create.l HWIO_PCIE_0_PCIE_USB3_PHY_ALFPS_DEGLITCH_VAL_ADDR A:0x600866cc
y.create.l HWIO_PCIE_0_PCIE_USB3_PHY_INSIG_SW_CTRL1_ADDR A:0x600866d0
y.create.l HWIO_PCIE_0_PCIE_USB3_PHY_INSIG_SW_CTRL2_ADDR A:0x600866d4
y.create.l HWIO_PCIE_0_PCIE_USB3_PHY_INSIG_SW_CTRL3_ADDR A:0x600866d8
y.create.l HWIO_PCIE_0_PCIE_USB3_PHY_INSIG_MX_CTRL1_ADDR A:0x600866dc
y.create.l HWIO_PCIE_0_PCIE_USB3_PHY_INSIG_MX_CTRL2_ADDR A:0x600866e0
y.create.l HWIO_PCIE_0_PCIE_USB3_PHY_INSIG_MX_CTRL3_ADDR A:0x600866e4
y.create.l HWIO_PCIE_0_PCIE_USB3_PHY_TEST_CONTROL_ADDR A:0x600866e8
y.create.l HWIO_PCIE_0_PCIE_USB3_PHY_BIST_CTRL_ADDR A:0x600866ec
y.create.l HWIO_PCIE_0_PCIE_USB3_PHY_PRBS_POLY0_ADDR A:0x600866f0
y.create.l HWIO_PCIE_0_PCIE_USB3_PHY_PRBS_POLY1_ADDR A:0x600866f4
y.create.l HWIO_PCIE_0_PCIE_USB3_PHY_PRBS_SEED0_ADDR A:0x600866f8
y.create.l HWIO_PCIE_0_PCIE_USB3_PHY_PRBS_SEED1_ADDR A:0x600866fc
y.create.l HWIO_PCIE_0_PCIE_USB3_PHY_FIXED_PAT_CTRL_ADDR A:0x60086700
y.create.l HWIO_PCIE_0_PCIE_USB3_PHY_FIXED_PAT0_ADDR A:0x60086704
y.create.l HWIO_PCIE_0_PCIE_USB3_PHY_FIXED_PAT1_ADDR A:0x60086708
y.create.l HWIO_PCIE_0_PCIE_USB3_PHY_FIXED_PAT2_ADDR A:0x6008670c
y.create.l HWIO_PCIE_0_PCIE_USB3_PHY_FIXED_PAT3_ADDR A:0x60086710
y.create.l HWIO_PCIE_0_PCIE_USB3_PHY_SPARE1_ADDR A:0x60086714
y.create.l HWIO_PCIE_0_PCIE_USB3_PHY_BIST_CHK_ERR_CNT_L_ADDR A:0x60086718
y.create.l HWIO_PCIE_0_PCIE_USB3_PHY_BIST_CHK_ERR_CNT_H_ADDR A:0x6008671c
y.create.l HWIO_PCIE_0_PCIE_USB3_PHY_BIST_CHK_STATUS_ADDR A:0x60086720
y.create.l HWIO_PCIE_0_PCIE_USB3_PHY_LFPS_RXTERM_IRQ_SOURCE_ADDR A:0x60086724
y.create.l HWIO_PCIE_0_PCIE_USB3_PHY_PCS_STATUS_ADDR A:0x60086728
y.create.l HWIO_PCIE_0_PCIE_USB3_PHY_PCS_STATUS2_ADDR A:0x6008672c
y.create.l HWIO_PCIE_0_PCIE_USB3_PHY_REVISION_ID0_ADDR A:0x60086730
y.create.l HWIO_PCIE_0_PCIE_USB3_PHY_REVISION_ID1_ADDR A:0x60086734
y.create.l HWIO_PCIE_0_PCIE_USB3_PHY_REVISION_ID2_ADDR A:0x60086738
y.create.l HWIO_PCIE_0_PCIE_USB3_PHY_REVISION_ID3_ADDR A:0x6008673c
y.create.l HWIO_PCIE_0_PCIE_USB3_PHY_DEBUG_BUS_0_STATUS_ADDR A:0x60086740
y.create.l HWIO_PCIE_0_PCIE_USB3_PHY_DEBUG_BUS_1_STATUS_ADDR A:0x60086744
y.create.l HWIO_PCIE_0_PCIE_USB3_PHY_DEBUG_BUS_2_STATUS_ADDR A:0x60086748
y.create.l HWIO_PCIE_0_PCIE_USB3_PHY_DEBUG_BUS_3_STATUS_ADDR A:0x6008674c
y.create.l HWIO_PCIE_0_PCIE20_MHI_MMIO_CTRL_INT_STATUS_Q6_ADDR A:0x60087000
y.create.l HWIO_PCIE_0_PCIE20_MHI_MMIO_CTRL_INT_STATUS_A7_ADDR A:0x60087004
y.create.l HWIO_PCIE_0_PCIE20_MHI_CHDB_INT_STATUS_Q6_0_ADDR A:0x60087008
y.create.l HWIO_PCIE_0_PCIE20_MHI_CHDB_INT_STATUS_Q6_1_ADDR A:0x6008700c
y.create.l HWIO_PCIE_0_PCIE20_MHI_CHDB_INT_STATUS_Q6_2_ADDR A:0x60087010
y.create.l HWIO_PCIE_0_PCIE20_MHI_CHDB_INT_STATUS_Q6_3_ADDR A:0x60087014
y.create.l HWIO_PCIE_0_PCIE20_MHI_ERDB_INT_STATUS_Q6_0_ADDR A:0x60087018
y.create.l HWIO_PCIE_0_PCIE20_MHI_ERDB_INT_STATUS_Q6_1_ADDR A:0x6008701c
y.create.l HWIO_PCIE_0_PCIE20_MHI_ERDB_INT_STATUS_Q6_2_ADDR A:0x60087020
y.create.l HWIO_PCIE_0_PCIE20_MHI_ERDB_INT_STATUS_Q6_3_ADDR A:0x60087024
y.create.l HWIO_PCIE_0_PCIE20_MHI_CHDB_INT_STATUS_A7_0_ADDR A:0x60087028
y.create.l HWIO_PCIE_0_PCIE20_MHI_CHDB_INT_STATUS_A7_1_ADDR A:0x6008702c
y.create.l HWIO_PCIE_0_PCIE20_MHI_CHDB_INT_STATUS_A7_2_ADDR A:0x60087030
y.create.l HWIO_PCIE_0_PCIE20_MHI_CHDB_INT_STATUS_A7_3_ADDR A:0x60087034
y.create.l HWIO_PCIE_0_PCIE20_MHI_ERDB_INT_STATUS_A7_0_ADDR A:0x60087038
y.create.l HWIO_PCIE_0_PCIE20_MHI_ERDB_INT_STATUS_A7_1_ADDR A:0x6008703c
y.create.l HWIO_PCIE_0_PCIE20_MHI_ERDB_INT_STATUS_A7_2_ADDR A:0x60087040
y.create.l HWIO_PCIE_0_PCIE20_MHI_ERDB_INT_STATUS_A7_3_ADDR A:0x60087044
y.create.l HWIO_PCIE_0_PCIE20_MHI_MMIO_CTRL_INT_CLEAR_Q6_ADDR A:0x60087048
y.create.l HWIO_PCIE_0_PCIE20_MHI_MMIO_CTRL_INT_CLEAR_A7_ADDR A:0x6008704c
y.create.l HWIO_PCIE_0_PCIE20_MHI_CHDB_INT_CLEAR_Q6_0_ADDR A:0x60087050
y.create.l HWIO_PCIE_0_PCIE20_MHI_CHDB_INT_CLEAR_Q6_1_ADDR A:0x60087054
y.create.l HWIO_PCIE_0_PCIE20_MHI_CHDB_INT_CLEAR_Q6_2_ADDR A:0x60087058
y.create.l HWIO_PCIE_0_PCIE20_MHI_CHDB_INT_CLEAR_Q6_3_ADDR A:0x6008705c
y.create.l HWIO_PCIE_0_PCIE20_MHI_ERDB_INT_CLEAR_Q6_0_ADDR A:0x60087060
y.create.l HWIO_PCIE_0_PCIE20_MHI_ERDB_INT_CLEAR_Q6_1_ADDR A:0x60087064
y.create.l HWIO_PCIE_0_PCIE20_MHI_ERDB_INT_CLEAR_Q6_2_ADDR A:0x60087068
y.create.l HWIO_PCIE_0_PCIE20_MHI_ERDB_INT_CLEAR_Q6_3_ADDR A:0x6008706c
y.create.l HWIO_PCIE_0_PCIE20_MHI_CHDB_INT_CLEAR_A7_0_ADDR A:0x60087070
y.create.l HWIO_PCIE_0_PCIE20_MHI_CHDB_INT_CLEAR_A7_1_ADDR A:0x60087074
y.create.l HWIO_PCIE_0_PCIE20_MHI_CHDB_INT_CLEAR_A7_2_ADDR A:0x60087078
y.create.l HWIO_PCIE_0_PCIE20_MHI_CHDB_INT_CLEAR_A7_3_ADDR A:0x6008707c
y.create.l HWIO_PCIE_0_PCIE20_MHI_ERDB_INT_CLEAR_A7_0_ADDR A:0x60087080
y.create.l HWIO_PCIE_0_PCIE20_MHI_ERDB_INT_CLEAR_A7_1_ADDR A:0x60087084
y.create.l HWIO_PCIE_0_PCIE20_MHI_ERDB_INT_CLEAR_A7_2_ADDR A:0x60087088
y.create.l HWIO_PCIE_0_PCIE20_MHI_ERDB_INT_CLEAR_A7_3_ADDR A:0x6008708c
y.create.l HWIO_PCIE_0_PCIE20_MHI_MMIO_CTRL_INT_MASK_Q6_ADDR A:0x60087090
y.create.l HWIO_PCIE_0_PCIE20_MHI_MMIO_CTRL_INT_MASK_A7_ADDR A:0x60087094
y.create.l HWIO_PCIE_0_PCIE20_MHI_CHDB_INT_MASK_Q6_0_ADDR A:0x60087098
y.create.l HWIO_PCIE_0_PCIE20_MHI_CHDB_INT_MASK_Q6_1_ADDR A:0x6008709c
y.create.l HWIO_PCIE_0_PCIE20_MHI_CHDB_INT_MASK_Q6_2_ADDR A:0x600870a0
y.create.l HWIO_PCIE_0_PCIE20_MHI_CHDB_INT_MASK_Q6_3_ADDR A:0x600870a4
y.create.l HWIO_PCIE_0_PCIE20_MHI_ERDB_INT_MASK_Q6_0_ADDR A:0x600870a8
y.create.l HWIO_PCIE_0_PCIE20_MHI_ERDB_INT_MASK_Q6_1_ADDR A:0x600870ac
y.create.l HWIO_PCIE_0_PCIE20_MHI_ERDB_INT_MASK_Q6_2_ADDR A:0x600870b0
y.create.l HWIO_PCIE_0_PCIE20_MHI_ERDB_INT_MASK_Q6_3_ADDR A:0x600870b4
y.create.l HWIO_PCIE_0_PCIE20_MHI_CHDB_INT_MASK_A7_0_ADDR A:0x600870b8
y.create.l HWIO_PCIE_0_PCIE20_MHI_CHDB_INT_MASK_A7_1_ADDR A:0x600870bc
y.create.l HWIO_PCIE_0_PCIE20_MHI_CHDB_INT_MASK_A7_2_ADDR A:0x600870c0
y.create.l HWIO_PCIE_0_PCIE20_MHI_CHDB_INT_MASK_A7_3_ADDR A:0x600870c4
y.create.l HWIO_PCIE_0_PCIE20_MHI_ERDB_INT_MASK_A7_0_ADDR A:0x600870c8
y.create.l HWIO_PCIE_0_PCIE20_MHI_ERDB_INT_MASK_A7_1_ADDR A:0x600870cc
y.create.l HWIO_PCIE_0_PCIE20_MHI_ERDB_INT_MASK_A7_2_ADDR A:0x600870d0
y.create.l HWIO_PCIE_0_PCIE20_MHI_ERDB_INT_MASK_A7_3_ADDR A:0x600870d4
y.create.l HWIO_PCIE_0_PCIE20_MHIREGLEN_ADDR A:0x60087100
y.create.l HWIO_PCIE_0_PCIE20_MHIVER_ADDR A:0x60087108
y.create.l HWIO_PCIE_0_PCIE20_MHICFG_ADDR A:0x60087110
y.create.l HWIO_PCIE_0_PCIE20_CHDBOFF_ADDR A:0x60087118
y.create.l HWIO_PCIE_0_PCIE20_ERDBOFF_ADDR A:0x60087120
y.create.l HWIO_PCIE_0_PCIE20_BHIOFF_ADDR A:0x60087128
y.create.l HWIO_PCIE_0_PCIE20_DEBUGOFF_ADDR A:0x60087130
y.create.l HWIO_PCIE_0_PCIE20_MHICTRL_ADDR A:0x60087138
y.create.l HWIO_PCIE_0_PCIE20_MHISTATUS_ADDR A:0x60087148
y.create.l HWIO_PCIE_0_PCIE20_MHIERROR_ADDR A:0x60087150
y.create.l HWIO_PCIE_0_PCIE20_CCABAP_LOWER_ADDR A:0x60087158
y.create.l HWIO_PCIE_0_PCIE20_CCABAP_UPPER_ADDR A:0x6008715c
y.create.l HWIO_PCIE_0_PCIE20_ECABAP_LOWER_ADDR A:0x60087160
y.create.l HWIO_PCIE_0_PCIE20_ECABAP_UPPER_ADDR A:0x60087164
y.create.l HWIO_PCIE_0_PCIE20_CRCBAP_LOWER_ADDR A:0x60087168
y.create.l HWIO_PCIE_0_PCIE20_CRCBAP_UPPER_ADDR A:0x6008716c
y.create.l HWIO_PCIE_0_PCIE20_CRDB_LOWER_ADDR A:0x60087170
y.create.l HWIO_PCIE_0_PCIE20_CRDB_UPPER_ADDR A:0x60087174
y.create.l HWIO_PCIE_0_PCIE20_MHICTRLBASE_LOWER_ADDR A:0x60087180
y.create.l HWIO_PCIE_0_PCIE20_MHICTRLBASE_UPPER_ADDR A:0x60087184
y.create.l HWIO_PCIE_0_PCIE20_MHICTRLLIMIT_LOWER_ADDR A:0x60087188
y.create.l HWIO_PCIE_0_PCIE20_MHICTRLLIMIT_UPPER_ADDR A:0x6008718c
y.create.l HWIO_PCIE_0_PCIE20_MHIDATABASE_LOWER_ADDR A:0x60087198
y.create.l HWIO_PCIE_0_PCIE20_MHIDATABASE_UPPER_ADDR A:0x6008719c
y.create.l HWIO_PCIE_0_PCIE20_MHIDATALIMIT_LOWER_ADDR A:0x600871a0
y.create.l HWIO_PCIE_0_PCIE20_MHIDATALIMIT_UPPER_ADDR A:0x600871a4
y.create.l HWIO_PCIE_0_PCIE20_BHI_VERSION_LOWER_ADDR A:0x60087200
y.create.l HWIO_PCIE_0_PCIE20_BHI_VERSION_UPPER_ADDR A:0x60087204
y.create.l HWIO_PCIE_0_PCIE20_BHI_IMGADDR_LOWER_ADDR A:0x60087208
y.create.l HWIO_PCIE_0_PCIE20_BHI_IMGADDR_UPPER_ADDR A:0x6008720c
y.create.l HWIO_PCIE_0_PCIE20_BHI_IMGSIZE_ADDR A:0x60087210
y.create.l HWIO_PCIE_0_PCIE20_BHI_IMGTXDB_ADDR A:0x60087218
y.create.l HWIO_PCIE_0_PCIE20_BHI_INTVEC_ADDR A:0x60087220
y.create.l HWIO_PCIE_0_PCIE20_BHI_EXECENV_ADDR A:0x60087228
y.create.l HWIO_PCIE_0_PCIE20_BHI_STATUS_ADDR A:0x6008722c
y.create.l HWIO_PCIE_0_PCIE20_BHI_ERRCODE_ADDR A:0x60087230
y.create.l HWIO_PCIE_0_PCIE20_BHI_ERRDBG1_ADDR A:0x60087234
y.create.l HWIO_PCIE_0_PCIE20_BHI_ERRDBG2_ADDR A:0x60087238
y.create.l HWIO_PCIE_0_PCIE20_BHI_ERRDBG3_ADDR A:0x6008723c
y.create.l HWIO_PCIE_0_PCIE20_BHI_SERIALNUM_ADDR A:0x60087240
y.create.l HWIO_PCIE_0_PCIE20_BHI_SBLANTIROLLVER_ADDR A:0x60087244
y.create.l HWIO_PCIE_0_PCIE20_BHI_NUMSEG_ADDR A:0x60087248
y.create.l HWIO_PCIE_0_PCIE20_BHI_MSMHWID_0_ADDR A:0x6008724c
y.create.l HWIO_PCIE_0_PCIE20_BHI_MSMHWID_1_ADDR A:0x60087250
y.create.l HWIO_PCIE_0_PCIE20_BHI_MSMHWID_2_ADDR A:0x60087254
y.create.l HWIO_PCIE_0_PCIE20_BHI_MSMHWID_3_ADDR A:0x60087258
y.create.l HWIO_PCIE_0_PCIE20_BHI_MSMHWID_4_ADDR A:0x6008725c
y.create.l HWIO_PCIE_0_PCIE20_BHI_MSMHWID_5_ADDR A:0x60087260
y.create.l HWIO_PCIE_0_PCIE20_BHI_OEMPKHASH_0_ADDR A:0x60087264
y.create.l HWIO_PCIE_0_PCIE20_BHI_OEMPKHASH_1_ADDR A:0x60087268
y.create.l HWIO_PCIE_0_PCIE20_BHI_OEMPKHASH_2_ADDR A:0x6008726c
y.create.l HWIO_PCIE_0_PCIE20_BHI_OEMPKHASH_3_ADDR A:0x60087270
y.create.l HWIO_PCIE_0_PCIE20_BHI_OEMPKHASH_4_ADDR A:0x60087274
y.create.l HWIO_PCIE_0_PCIE20_BHI_OEMPKHASH_5_ADDR A:0x60087278
y.create.l HWIO_PCIE_0_PCIE20_BHI_OEMPKHASH_6_ADDR A:0x6008727c
y.create.l HWIO_PCIE_0_PCIE20_BHI_OEMPKHASH_7_ADDR A:0x60087280
y.create.l HWIO_PCIE_0_PCIE20_BHI_OEMPKHASH_8_ADDR A:0x60087284
y.create.l HWIO_PCIE_0_PCIE20_BHI_OEMPKHASH_9_ADDR A:0x60087288
y.create.l HWIO_PCIE_0_PCIE20_CHDB_LOWER_0_ADDR A:0x60087400
y.create.l HWIO_PCIE_0_PCIE20_CHDB_LOWER_1_ADDR A:0x60087408
y.create.l HWIO_PCIE_0_PCIE20_CHDB_LOWER_2_ADDR A:0x60087410
y.create.l HWIO_PCIE_0_PCIE20_CHDB_LOWER_3_ADDR A:0x60087418
y.create.l HWIO_PCIE_0_PCIE20_CHDB_LOWER_4_ADDR A:0x60087420
y.create.l HWIO_PCIE_0_PCIE20_CHDB_LOWER_5_ADDR A:0x60087428
y.create.l HWIO_PCIE_0_PCIE20_CHDB_LOWER_6_ADDR A:0x60087430
y.create.l HWIO_PCIE_0_PCIE20_CHDB_LOWER_7_ADDR A:0x60087438
y.create.l HWIO_PCIE_0_PCIE20_CHDB_LOWER_8_ADDR A:0x60087440
y.create.l HWIO_PCIE_0_PCIE20_CHDB_LOWER_9_ADDR A:0x60087448
y.create.l HWIO_PCIE_0_PCIE20_CHDB_UPPER_0_ADDR A:0x60087404
y.create.l HWIO_PCIE_0_PCIE20_CHDB_UPPER_1_ADDR A:0x6008740c
y.create.l HWIO_PCIE_0_PCIE20_CHDB_UPPER_2_ADDR A:0x60087414
y.create.l HWIO_PCIE_0_PCIE20_CHDB_UPPER_3_ADDR A:0x6008741c
y.create.l HWIO_PCIE_0_PCIE20_CHDB_UPPER_4_ADDR A:0x60087424
y.create.l HWIO_PCIE_0_PCIE20_CHDB_UPPER_5_ADDR A:0x6008742c
y.create.l HWIO_PCIE_0_PCIE20_CHDB_UPPER_6_ADDR A:0x60087434
y.create.l HWIO_PCIE_0_PCIE20_CHDB_UPPER_7_ADDR A:0x6008743c
y.create.l HWIO_PCIE_0_PCIE20_CHDB_UPPER_8_ADDR A:0x60087444
y.create.l HWIO_PCIE_0_PCIE20_CHDB_UPPER_9_ADDR A:0x6008744c
y.create.l HWIO_PCIE_0_PCIE20_ERDB_LOWER_0_ADDR A:0x60087800
y.create.l HWIO_PCIE_0_PCIE20_ERDB_LOWER_1_ADDR A:0x60087808
y.create.l HWIO_PCIE_0_PCIE20_ERDB_LOWER_2_ADDR A:0x60087810
y.create.l HWIO_PCIE_0_PCIE20_ERDB_LOWER_3_ADDR A:0x60087818
y.create.l HWIO_PCIE_0_PCIE20_ERDB_LOWER_4_ADDR A:0x60087820
y.create.l HWIO_PCIE_0_PCIE20_ERDB_LOWER_5_ADDR A:0x60087828
y.create.l HWIO_PCIE_0_PCIE20_ERDB_LOWER_6_ADDR A:0x60087830
y.create.l HWIO_PCIE_0_PCIE20_ERDB_LOWER_7_ADDR A:0x60087838
y.create.l HWIO_PCIE_0_PCIE20_ERDB_LOWER_8_ADDR A:0x60087840
y.create.l HWIO_PCIE_0_PCIE20_ERDB_LOWER_9_ADDR A:0x60087848
y.create.l HWIO_PCIE_0_PCIE20_ERDB_UPPER_0_ADDR A:0x60087804
y.create.l HWIO_PCIE_0_PCIE20_ERDB_UPPER_1_ADDR A:0x6008780c
y.create.l HWIO_PCIE_0_PCIE20_ERDB_UPPER_2_ADDR A:0x60087814
y.create.l HWIO_PCIE_0_PCIE20_ERDB_UPPER_3_ADDR A:0x6008781c
y.create.l HWIO_PCIE_0_PCIE20_ERDB_UPPER_4_ADDR A:0x60087824
y.create.l HWIO_PCIE_0_PCIE20_ERDB_UPPER_5_ADDR A:0x6008782c
y.create.l HWIO_PCIE_0_PCIE20_ERDB_UPPER_6_ADDR A:0x60087834
y.create.l HWIO_PCIE_0_PCIE20_ERDB_UPPER_7_ADDR A:0x6008783c
y.create.l HWIO_PCIE_0_PCIE20_ERDB_UPPER_8_ADDR A:0x60087844
y.create.l HWIO_PCIE_0_PCIE20_ERDB_UPPER_9_ADDR A:0x6008784c
y.create.l HWIO_PCIE_0_PCIE20_PARF_DEBUG_CNT_INT_SLV_XPU2_MSA_ADDR A:0x60087c00
y.create.l HWIO_PCIE_0_PCIE20_PARF_DEBUG_CNT_PM_LINKST_IN_L2_ADDR A:0x60087c04
y.create.l HWIO_PCIE_0_PCIE20_PARF_DEBUG_CNT_PM_LINKST_IN_L1SUB_ADDR A:0x60087c08
y.create.l HWIO_PCIE_0_PCIE20_PARF_DEBUG_CNT_PM_LINKST_IN_L1_ADDR A:0x60087c0c
y.create.l HWIO_PCIE_0_PCIE20_PARF_DEBUG_CNT_PM_LINKST_IN_L0S_ADDR A:0x60087c10
y.create.l HWIO_PCIE_0_PCIE20_PARF_DEBUG_CNT_AUX_CLK_APP_REQ_EXIT_L1_ADDR A:0x60087c14
y.create.l HWIO_PCIE_0_PCIE20_PARF_DEBUG_CNT_AUX_CLK_APP_READY_ENTER_L23_ADDR A:0x60087c18
y.create.l HWIO_PCIE_0_PCIE20_PARF_DEBUG_CNT_AUX_CLK_APP_READY_ENTER_L1_ADDR A:0x60087c1c
y.create.l HWIO_PCIE_0_PCIE20_PARF_DEBUG_CNT_INT_BRIDGE_FLUSH_ADDR A:0x60087c20
y.create.l HWIO_PCIE_0_PCIE20_PARF_DEBUG_CNT_ECRC_ERR_ASSERTED_ADDR A:0x60087c24
y.create.l HWIO_PCIE_0_PCIE20_PARF_DEBUG_CNT_LCRC_ERR_ASSERTED_ADDR A:0x60087c28
y.create.l HWIO_PCIE_0_PCIE20_PARF_DEBUG_CNT_RMLH_RDLH_PKTERR_1_ADDR A:0x60087c2c
y.create.l HWIO_PCIE_0_PCIE20_PARF_DEBUG_CNT_RMLH_RDLH_PKTERR_0_ADDR A:0x60087c30
y.create.l HWIO_PCIE_0_PCIE20_PARF_DEBUG_CNT_RMLH_DESKEW_ALIGN_ERR_ADDR A:0x60087c34
y.create.l HWIO_PCIE_0_PCIE20_PARF_DEBUG_CNT_RMLK_TS_RCV_ERR_ADDR A:0x60087c38
y.create.l HWIO_PCIE_0_PCIE20_PARF_DEBUG_CNT_UNEXP_CPL_ERR_ADDR A:0x60087c3c
y.create.l HWIO_PCIE_0_PCIE20_PARF_DEBUG_CNT_CPL_CA_ERR_ADDR A:0x60087c40
y.create.l HWIO_PCIE_0_PCIE20_PARF_DEBUG_CNT_CPL_UR_ERR_ADDR A:0x60087c44
y.create.l HWIO_PCIE_0_PCIE20_PARF_DEBUG_CNT_CPL_MLF_ERR_ADDR A:0x60087c48
y.create.l HWIO_PCIE_0_PCIE20_PARF_DEBUG_CNT_FORM_FILT_ECRC_ERR_ADDR A:0x60087c4c
y.create.l HWIO_PCIE_0_PCIE20_PARF_DEBUG_CNT_FORM_FILT_MALFORM_TLP_ERR_ADDR A:0x60087c50
y.create.l HWIO_PCIE_0_PCIE20_PARF_DEBUG_CNT_FORM_FILT_DLLP_ERR_ADDR A:0x60087c54
y.create.l HWIO_PCIE_0_PCIE20_PARF_DEBUG_CNT_XDLH_REPLAY_TIMEOUT_ERR_ADDR A:0x60087c58
y.create.l HWIO_PCIE_0_PCIE20_PARF_DEBUG_CNT_XDLH_REPLAY_NUM_RLOVER_ERR_ADDR A:0x60087c5c
y.create.l HWIO_PCIE_0_PCIE20_PARF_DEBUG_CNT_RDLH_BAD_DLLP_ERR_ADDR A:0x60087c60
y.create.l HWIO_PCIE_0_PCIE20_PARF_DEBUG_CNT_RDLH_BAD_TLP_ERR_ADDR A:0x60087c64
y.create.l HWIO_PCIE_0_PCIE20_PARF_DEBUG_CNT_RDLH_PROT_ERR_ADDR A:0x60087c68
y.create.l HWIO_PCIE_0_PCIE20_PARF_DEBUG_CNT_RMLH_RCVD_ERR_ADDR A:0x60087c6c
y.create.l HWIO_PCIE_0_PCIE20_PARF_DEBUG_CNT_RADM_CPL_TIMEOUT_ADDR A:0x60087c70
y.create.l HWIO_PCIE_0_PCIE20_PARF_DEBUG_CNT_RADM_QOVERFLOW_ADDR A:0x60087c74
y.create.l HWIO_PCIE_0_PCIE20_PARF_DEBUG_CNT_RADM_UNEXP_CPL_ERR_ADDR A:0x60087c78
y.create.l HWIO_PCIE_0_PCIE20_PARF_DEBUG_CNT_RADM_ECRC_ERR_ADDR A:0x60087c7c
y.create.l HWIO_PCIE_0_PCIE20_PARF_DEBUG_CNT_RADM_MLF_TLP_ERR_ADDR A:0x60087c80
y.create.l HWIO_PCIE_0_PCIE20_PARF_DEBUG_CNT_AUX_CLK_IN_L1SUB_L1_ADDR A:0x60087c84
y.create.l HWIO_PCIE_0_PCIE20_PARF_DEBUG_CNT_AUX_CLK_IN_L1SUB_L2_ADDR A:0x60087c88
y.create.l HWIO_PCIE_0_PCIE20_PARF_DEBUG_CNT_AUX_CLK_D_STATE_CHANGE_ADDR A:0x60087c8c
y.create.l HWIO_PCIE_0_TYPE1_DEV_ID_VEND_ID_REG_ADDR A:0x40000000
y.create.l HWIO_PCIE_0_TYPE1_STATUS_COMMAND_REG_ADDR A:0x40000004
y.create.l HWIO_PCIE_0_TYPE1_CLASS_CODE_REV_ID_REG_ADDR A:0x40000008
y.create.l HWIO_PCIE_0_TYPE1_BIST_HDR_TYPE_LAT_CACHE_LINE_SIZE_REG_ADDR A:0x4000000c
y.create.l HWIO_PCIE_0_BAR0_REG_ADDR A:0x40000010
y.create.l HWIO_PCIE_0_BAR1_REG_ADDR A:0x40000014
y.create.l HWIO_PCIE_0_SEC_LAT_TIMER_SUB_BUS_SEC_BUS_PRI_BUS_REG_ADDR A:0x40000018
y.create.l HWIO_PCIE_0_SEC_STAT_IO_LIMIT_IO_BASE_REG_ADDR A:0x4000001c
y.create.l HWIO_PCIE_0_MEM_LIMIT_MEM_BASE_REG_ADDR A:0x40000020
y.create.l HWIO_PCIE_0_PREF_MEM_LIMIT_PREF_MEM_BASE_REG_ADDR A:0x40000024
y.create.l HWIO_PCIE_0_PREF_BASE_UPPER_REG_ADDR A:0x40000028
y.create.l HWIO_PCIE_0_PREF_LIMIT_UPPER_REG_ADDR A:0x4000002c
y.create.l HWIO_PCIE_0_IO_LIMIT_UPPER_IO_BASE_UPPER_REG_ADDR A:0x40000030
y.create.l HWIO_PCIE_0_TYPE1_CAP_PTR_REG_ADDR A:0x40000034
y.create.l HWIO_PCIE_0_TYPE1_EXP_ROM_BASE_REG_ADDR A:0x40000038
y.create.l HWIO_PCIE_0_BRIDGE_CTRL_INT_PIN_INT_LINE_REG_ADDR A:0x4000003c
y.create.l HWIO_PCIE_0_L1SUB_CAP_HEADER_REG_ADDR A:0x40000150
y.create.l HWIO_PCIE_0_L1SUB_CAPABILITY_REG_ADDR A:0x40000154
y.create.l HWIO_PCIE_0_L1SUB_CONTROL1_REG_ADDR A:0x40000158
y.create.l HWIO_PCIE_0_L1SUB_CONTROL2_REG_ADDR A:0x4000015c
y.create.l HWIO_PCIE_0_CAP_ID_NXT_PTR_REG_ADDR A:0x40000040
y.create.l HWIO_PCIE_0_CON_STATUS_REG_ADDR A:0x40000044
y.create.l HWIO_PCIE_0_PCIE_CAP_ID_PCIE_NEXT_CAP_PTR_PCIE_CAP_REG_ADDR A:0x40000070
y.create.l HWIO_PCIE_0_DEVICE_CAPABILITIES_REG_ADDR A:0x40000074
y.create.l HWIO_PCIE_0_DEVICE_CONTROL_DEVICE_STATUS_ADDR A:0x40000078
y.create.l HWIO_PCIE_0_LINK_CAPABILITIES_REG_ADDR A:0x4000007c
y.create.l HWIO_PCIE_0_LINK_CONTROL_LINK_STATUS_REG_ADDR A:0x40000080
y.create.l HWIO_PCIE_0_ROOT_CONTROL_ROOT_CAPABILITIES_REG_ADDR A:0x4000008c
y.create.l HWIO_PCIE_0_ROOT_STATUS_REG_ADDR A:0x40000090
y.create.l HWIO_PCIE_0_DEVICE_CAPABILITIES2_REG_ADDR A:0x40000094
y.create.l HWIO_PCIE_0_DEVICE_CONTROL2_DEVICE_STATUS2_REG_ADDR A:0x40000098
y.create.l HWIO_PCIE_0_LINK_CAPABILITIES2_REG_ADDR A:0x4000009c
y.create.l HWIO_PCIE_0_LINK_CONTROL2_LINK_STATUS2_REG_ADDR A:0x400000a0
y.create.l HWIO_PCIE_0_AER_EXT_CAP_HDR_REG_ADDR A:0x40000100
y.create.l HWIO_PCIE_0_UNCORR_ERR_STATUS_REG_ADDR A:0x40000104
y.create.l HWIO_PCIE_0_UNCORR_ERR_MASK_REG_ADDR A:0x40000108
y.create.l HWIO_PCIE_0_UNCORR_ERR_SEV_REG_ADDR A:0x4000010c
y.create.l HWIO_PCIE_0_CORR_ERR_STATUS_REG_ADDR A:0x40000110
y.create.l HWIO_PCIE_0_CORR_ERR_MASK_REG_ADDR A:0x40000114
y.create.l HWIO_PCIE_0_ADV_ERR_CAP_CTRL_REG_ADDR A:0x40000118
y.create.l HWIO_PCIE_0_HDR_LOG_REG_0_ADDR A:0x4000011c
y.create.l HWIO_PCIE_0_HDR_LOG_REG_1_ADDR A:0x40000120
y.create.l HWIO_PCIE_0_HDR_LOG_REG_2_ADDR A:0x40000124
y.create.l HWIO_PCIE_0_HDR_LOG_REG_3_ADDR A:0x40000128
y.create.l HWIO_PCIE_0_ROOT_ERR_CMD_REG_ADDR A:0x4000012c
y.create.l HWIO_PCIE_0_ROOT_ERR_STATUS_REG_ADDR A:0x40000130
y.create.l HWIO_PCIE_0_ERR_SRC_ID_REG_ADDR A:0x40000134
y.create.l HWIO_PCIE_0_TLP_PREFIX_LOG_REG_ADDR A:0x40000138
y.create.l HWIO_PCIE_0_PCI_MSI_CAP_ID_NEXT_CTRL_REG_ADDR A:0x40000050
y.create.l HWIO_PCIE_0_MSI_LOWER_32_ADDR A:0x40000054
y.create.l HWIO_PCIE_0_MSI_UPPER_32_ADDR A:0x40000058
y.create.l HWIO_PCIE_0_MSI_DATA_REG_ADDR A:0x4000005c
y.create.l HWIO_PCIE_0_MSI_MASK_REG_ADDR A:0x40000060
y.create.l HWIO_PCIE_0_MSI_PENDING_BIT_REG_ADDR A:0x40000064
y.create.l HWIO_PCIE_0_LTR_CAP_HDR_REG_ADDR A:0x40000148
y.create.l HWIO_PCIE_0_LTR_LATENCY_REG_ADDR A:0x4000014c
y.create.l HWIO_PCIE_0_ACK_LATENCY_TIMER_ADDR A:0x40000700
y.create.l HWIO_PCIE_0_VENDOR_SPEC_DLLP_REG_ADDR A:0x40000704
y.create.l HWIO_PCIE_0_PORT_FORCE_REG_ADDR A:0x40000708
y.create.l HWIO_PCIE_0_ACK_F_ASPM_CTRL_REG_ADDR A:0x4000070c
y.create.l HWIO_PCIE_0_PORT_LINK_CTRL_REG_ADDR A:0x40000710
y.create.l HWIO_PCIE_0_LANE_SKEW_REG_ADDR A:0x40000714
y.create.l HWIO_PCIE_0_TIMER_CTRL_MAX_FUNC_NUM_ADDR A:0x40000718
y.create.l HWIO_PCIE_0_SYMBOL_TIMER_FILTER_1_REG_ADDR A:0x4000071c
y.create.l HWIO_PCIE_0_FILTER_MASK_REG_2_ADDR A:0x40000720
y.create.l HWIO_PCIE_0_AMBA_MUL_OB_DECOMP_NP_SUB_REQ_CTRL_REG_ADDR A:0x40000724
y.create.l HWIO_PCIE_0_DEBUG_REG_0_ADDR A:0x40000728
y.create.l HWIO_PCIE_0_DEBUG_REG_1_ADDR A:0x4000072c
y.create.l HWIO_PCIE_0_TX_P_FC_CREDIT_STATUS_ADDR A:0x40000730
y.create.l HWIO_PCIE_0_TX_NP_FC_CREDIT_STATUS_ADDR A:0x40000734
y.create.l HWIO_PCIE_0_TX_CPL_FC_CREDIT_STATUS_ADDR A:0x40000738
y.create.l HWIO_PCIE_0_Q_STATUS_ADDR A:0x4000073c
y.create.l HWIO_PCIE_0_VC_TX_ARBI_REG_1_ADDR A:0x40000740
y.create.l HWIO_PCIE_0_VC_TX_ARBI_REG_2_ADDR A:0x40000744
y.create.l HWIO_PCIE_0_VC0_P_RX_Q_CTRL_ADDR A:0x40000748
y.create.l HWIO_PCIE_0_VC0_NP_RX_Q_CTRL_ADDR A:0x4000074c
y.create.l HWIO_PCIE_0_VC0_CPL_RX_Q_CTRL_ADDR A:0x40000750
y.create.l HWIO_PCIE_0_VC1_P_RX_Q_CTRL_ADDR A:0x40000754
y.create.l HWIO_PCIE_0_VC1_NP_RX_Q_CTRL_ADDR A:0x40000758
y.create.l HWIO_PCIE_0_VC1_CPL_RX_Q_CTRL_ADDR A:0x4000075c
y.create.l HWIO_PCIE_0_VC2_P_RX_Q_CTRL_ADDR A:0x40000760
y.create.l HWIO_PCIE_0_VC2_NP_RX_Q_CTRL_ADDR A:0x40000764
y.create.l HWIO_PCIE_0_VC2_CPL_RX_Q_CTRL_ADDR A:0x40000768
y.create.l HWIO_PCIE_0_VC3_P_RX_Q_CTRL_ADDR A:0x4000076c
y.create.l HWIO_PCIE_0_VC3_NP_RX_Q_CTRL_ADDR A:0x40000770
y.create.l HWIO_PCIE_0_VC3_CPL_RX_Q_CTRL_ADDR A:0x40000774
y.create.l HWIO_PCIE_0_VC4_P_RX_Q_CTRL_ADDR A:0x40000778
y.create.l HWIO_PCIE_0_VC4_NP_RX_Q_CTRL_ADDR A:0x4000077c
y.create.l HWIO_PCIE_0_VC4_CPL_RX_Q_CTRL_ADDR A:0x40000780
y.create.l HWIO_PCIE_0_VC5_P_RX_Q_CTRL_ADDR A:0x40000784
y.create.l HWIO_PCIE_0_VC5_NP_RX_Q_CTRL_ADDR A:0x40000788
y.create.l HWIO_PCIE_0_VC5_CPL_RX_Q_CTRL_ADDR A:0x4000078c
y.create.l HWIO_PCIE_0_VC6_P_RX_Q_CTRL_ADDR A:0x40000790
y.create.l HWIO_PCIE_0_VC6_NP_RX_Q_CTRL_ADDR A:0x40000794
y.create.l HWIO_PCIE_0_VC6_CPL_RX_Q_CTRL_ADDR A:0x40000798
y.create.l HWIO_PCIE_0_VC7_P_RX_Q_CTRL_ADDR A:0x4000079c
y.create.l HWIO_PCIE_0_VC7_NP_RX_Q_CTRL_ADDR A:0x400007a0
y.create.l HWIO_PCIE_0_VC7_CPL_RX_Q_CTRL_ADDR A:0x400007a4
y.create.l HWIO_PCIE_0_GEN2_CTRL_REG_ADDR A:0x4000080c
y.create.l HWIO_PCIE_0_PHY_STATUS_REG_ADDR A:0x40000810
y.create.l HWIO_PCIE_0_PHY_CONTROL_REG_ADDR A:0x40000814
y.create.l HWIO_PCIE_0_AXI_MASTER_CTRL_REG_0_ADDR A:0x40000818
y.create.l HWIO_PCIE_0_AXI_MASTER_CTRL_REG_1_ADDR A:0x4000081c
y.create.l HWIO_PCIE_0_MSI_CTRL_ADDR_REG_ADDR A:0x40000820
y.create.l HWIO_PCIE_0_MSI_CTRL_UPPER_ADDR_REG_ADDR A:0x40000824
y.create.l HWIO_PCIE_0_MSI_CTRL_INT_0_EN_REG_ADDR A:0x40000828
y.create.l HWIO_PCIE_0_MSI_CTRL_INT_0_MASK_REG_ADDR A:0x4000082c
y.create.l HWIO_PCIE_0_MSI_CTRL_INT_0_STATUS_REG_ADDR A:0x40000830
y.create.l HWIO_PCIE_0_MSI_CTRL_INT_1_EN_REG_ADDR A:0x40000834
y.create.l HWIO_PCIE_0_MSI_CTRL_INT_1_MASK_REG_ADDR A:0x40000838
y.create.l HWIO_PCIE_0_MSI_CTRL_INT_1_STATUS_REG_ADDR A:0x4000083c
y.create.l HWIO_PCIE_0_MSI_CTRL_INT_2_EN_REG_ADDR A:0x40000840
y.create.l HWIO_PCIE_0_MSI_CTRL_INT_2_MASK_REG_ADDR A:0x40000844
y.create.l HWIO_PCIE_0_MSI_CTRL_INT_2_STATUS_REG_ADDR A:0x40000848
y.create.l HWIO_PCIE_0_MSI_CTRL_INT_3_EN_REG_ADDR A:0x4000084c
y.create.l HWIO_PCIE_0_MSI_CTRL_INT_3_MASK_REG_ADDR A:0x40000850
y.create.l HWIO_PCIE_0_MSI_CTRL_INT_3_STATUS_REG_ADDR A:0x40000854
y.create.l HWIO_PCIE_0_MSI_CTRL_INT_4_EN_REG_ADDR A:0x40000858
y.create.l HWIO_PCIE_0_MSI_CTRL_INT_4_MASK_REG_ADDR A:0x4000085c
y.create.l HWIO_PCIE_0_MSI_CTRL_INT_4_STATUS_REG_ADDR A:0x40000860
y.create.l HWIO_PCIE_0_MSI_CTRL_INT_5_EN_REG_ADDR A:0x40000864
y.create.l HWIO_PCIE_0_MSI_CTRL_INT_5_MASK_REG_ADDR A:0x40000868
y.create.l HWIO_PCIE_0_MSI_CTRL_INT_5_STATUS_REG_ADDR A:0x4000086c
y.create.l HWIO_PCIE_0_MSI_CTRL_INT_6_EN_REG_ADDR A:0x40000870
y.create.l HWIO_PCIE_0_MSI_CTRL_INT_6_MASK_REG_ADDR A:0x40000874
y.create.l HWIO_PCIE_0_MSI_CTRL_INT_6_STATUS_REG_ADDR A:0x40000878
y.create.l HWIO_PCIE_0_MSI_CTRL_INT_7_EN_REG_ADDR A:0x4000087c
y.create.l HWIO_PCIE_0_MSI_CTRL_INT_7_MASK_REG_ADDR A:0x40000880
y.create.l HWIO_PCIE_0_MSI_CTRL_INT_7_STATUS_REG_ADDR A:0x40000884
y.create.l HWIO_PCIE_0_MSI_GPIO_IO_REG_ADDR A:0x40000888
y.create.l HWIO_PCIE_0_GEN3_RELATED_REG_ADDR A:0x40000890
y.create.l HWIO_PCIE_0_GEN3_EQ_LOCAL_FS_LF_REG_ADDR A:0x40000894
y.create.l HWIO_PCIE_0_GEN3_EQ_PSET_COEF_MAP_0_ADDR A:0x40000898
y.create.l HWIO_PCIE_0_GEN3_EQ_PSET_INDEX_REG_ADDR A:0x4000089c
y.create.l HWIO_PCIE_0_GEN3_EQ_COEFF_LEGALITY_STATUS_REG_ADDR A:0x400008a4
y.create.l HWIO_PCIE_0_GEN3_EQ_CONTROL_REG_ADDR A:0x400008a8
y.create.l HWIO_PCIE_0_GEN3_EQ_FB_MODE_DIR_CHANGE_REG_ADDR A:0x400008ac
y.create.l HWIO_PCIE_0_PIPE_LOOPBACK_CONTROL_ADDR A:0x400008b8
y.create.l HWIO_PCIE_0_MISC_CONTROL_1_REG_ADDR A:0x400008bc
y.create.l HWIO_PCIE_0_AMBA_ERROR_RESPONSE_DEFAULT_REG_ADDR A:0x400008d0
y.create.l HWIO_PCIE_0_AMBA_LINK_TIMEOUT_REG_ADDR A:0x400008d4
y.create.l HWIO_PCIE_0_AMBA_ORDERING_CTRL_OFF_ADDR A:0x400008d8
y.create.l HWIO_PCIE_0_PL_LAST_REG_ADDR A:0x400008fc
y.create.l HWIO_PCIE_0_IATU_VIEWPORT_REG_ADDR A:0x40000900
y.create.l HWIO_PCIE_0_PL_IATU_REGION_CTRL_REG_1_OUTBOUND_0_ADDR A:0x40000904
y.create.l HWIO_PCIE_0_PL_IATU_REGION_CTRL_REG_2_OUTBOUND_0_ADDR A:0x40000908
y.create.l HWIO_PCIE_0_PL_IATU_LWR_BASE_ADDR_REG_OUTBOUND_0_ADDR A:0x4000090c
y.create.l HWIO_PCIE_0_PL_IATU_UPPER_BASE_ADDR_REG_OUTBOUND_0_ADDR A:0x40000910
y.create.l HWIO_PCIE_0_PL_IATU_LIMIT_ADDR_REG_OUTBOUND_0_ADDR A:0x40000914
y.create.l HWIO_PCIE_0_PL_IATU_LWR_TARGET_ADDR_REG_OUTBOUND_0_ADDR A:0x40000918
y.create.l HWIO_PCIE_0_PL_IATU_UPPER_TARGET_ADDR_REG_OUTBOUND_0_ADDR A:0x4000091c
y.create.l HWIO_PCIE_0_PL_IATU_REGION_CTRL_REG_3_OUTBOUND_0_ADDR A:0x40000920
y.create.l HWIO_PCIE_0_DMA_CTRL_REG_ADDR A:0x40000978
y.create.l HWIO_PCIE_0_DMA_WRITE_ENGINE_EN_ADDR A:0x4000097c
y.create.l HWIO_PCIE_0_DMA_WRITE_DOORBELL_REG_ADDR A:0x40000980
y.create.l HWIO_PCIE_0_DMA_WRITE_CHANNEL_ARB_WEIGHT_LOW_REG_ADDR A:0x40000988
y.create.l HWIO_PCIE_0_DMA_WRITE_CHANNEL_ARB_WEIGHT_HIGH_REG_ADDR A:0x4000098c
y.create.l HWIO_PCIE_0_DMA_WRITE_P_REQ_TIMER_REG_ADDR A:0x40000998
y.create.l HWIO_PCIE_0_DMA_READ_ENGINE_EN_ADDR A:0x4000099c
y.create.l HWIO_PCIE_0_DMA_READ_DOORBELL_REG_ADDR A:0x400009a0
y.create.l HWIO_PCIE_0_DMA_READ_CHANNEL_ARB_WEIGHT_LOW_REG_ADDR A:0x400009a8
y.create.l HWIO_PCIE_0_DMA_READ_CHANNEL_ARB_WEIGHT_HIGH_REG_ADDR A:0x400009ac
y.create.l HWIO_PCIE_0_DMA_WRITE_INT_STATUS_REG_ADDR A:0x400009bc
y.create.l HWIO_PCIE_0_DMA_WRITE_INT_MASK_REG_ADDR A:0x400009c4
y.create.l HWIO_PCIE_0_DMA_WRITE_INT_CLEAR_REG_ADDR A:0x400009c8
y.create.l HWIO_PCIE_0_DMA_WRITE_ERR_STATUS_REG_ADDR A:0x400009cc
y.create.l HWIO_PCIE_0_DMA_WRITE_DONE_IMWR_LOW_REG_ADDR A:0x400009d0
y.create.l HWIO_PCIE_0_DMA_WRITE_DONE_IMWR_HIGH_REG_ADDR A:0x400009d4
y.create.l HWIO_PCIE_0_DMA_WRITE_ABORT_IMWR_LOW_REG_ADDR A:0x400009d8
y.create.l HWIO_PCIE_0_DMA_WRITE_ABORT_IMWR_HIGH_REG_ADDR A:0x400009dc
y.create.l HWIO_PCIE_0_DMA_WRITE_CH01_IMWR_DATA_REG_ADDR A:0x400009e0
y.create.l HWIO_PCIE_0_DMA_WRITE_LINKED_LIST_ERR_EN_REG_ADDR A:0x40000a00
y.create.l HWIO_PCIE_0_DMA_READ_INT_STATUS_REG_ADDR A:0x40000a10
y.create.l HWIO_PCIE_0_DMA_READ_INT_MASK_REG_ADDR A:0x40000a18
y.create.l HWIO_PCIE_0_DMA_READ_INT_CLEAR_REG_ADDR A:0x40000a1c
y.create.l HWIO_PCIE_0_DMA_READ_ERR_STATUS_LOW_REG_ADDR A:0x40000a24
y.create.l HWIO_PCIE_0_DMA_READ_ERR_STATUS_HIGH_REG_ADDR A:0x40000a28
y.create.l HWIO_PCIE_0_DMA_READ_LINKED_LIST_ERR_EN_REG_ADDR A:0x40000a34
y.create.l HWIO_PCIE_0_DMA_READ_DONE_IMWR_LOW_REG_ADDR A:0x40000a3c
y.create.l HWIO_PCIE_0_DMA_READ_DONE_IMWR_HIGH_REG_ADDR A:0x40000a40
y.create.l HWIO_PCIE_0_DMA_READ_ABORT_IMWR_LOW_REG_ADDR A:0x40000a44
y.create.l HWIO_PCIE_0_DMA_READ_ABORT_IMWR_HIGH_REG_ADDR A:0x40000a48
y.create.l HWIO_PCIE_0_DMA_READ_CH01_IMWR_DATA_REG_ADDR A:0x40000a4c
y.create.l HWIO_PCIE_0_DMA_VIEWPORT_SEL_REG_ADDR A:0x40000a6c
y.create.l HWIO_PCIE_0_DMA_CH_CONTROL1_REG_WRCH_0_ADDR A:0x40000a70
y.create.l HWIO_PCIE_0_DMA_CH_CONTROL2_REG_WRCH_0_ADDR A:0x40000a74
y.create.l HWIO_PCIE_0_DMA_TRANSFER_SIZE_REG_WRCH_0_ADDR A:0x40000a78
y.create.l HWIO_PCIE_0_DMA_SAR_LOW_REG_WRCH_0_ADDR A:0x40000a7c
y.create.l HWIO_PCIE_0_DMA_SAR_HIGH_REG_WRCH_0_ADDR A:0x40000a80
y.create.l HWIO_PCIE_0_DMA_DAR_LOW_REG_WRCH_0_ADDR A:0x40000a84
y.create.l HWIO_PCIE_0_DMA_DAR_HIGH_REG_WRCH_0_ADDR A:0x40000a88
y.create.l HWIO_PCIE_0_DMA_LLP_LOW_REG_WRCH_0_ADDR A:0x40000a8c
y.create.l HWIO_PCIE_0_DMA_LLP_HIGH_REG_WRCH_0_ADDR A:0x40000a90
y.create.l HWIO_PCIE_0_PL_LTR_LATENCY_REG_ADDR A:0x40000b30
y.create.l HWIO_PCIE_0_AUX_CLK_FREQ_REG_ADDR A:0x40000b40
y.create.l HWIO_PCIE_0_L1_SUBSTATES_REG_ADDR A:0x40000b44
y.create.l HWIO_PCIE_0_TYPE0_DEVICE_ID_VENDOR_ID_REG_1_ADDR A:0x40000000
y.create.l HWIO_PCIE_0_TYPE0_STATUS_COMMAND_REG_1_ADDR A:0x40000004
y.create.l HWIO_PCIE_0_TYPE0_CLASS_CODE_REVISION_ID_1_ADDR A:0x40000008
y.create.l HWIO_PCIE_0_TYPE0_BIST_HEADER_TYPE_LATENCY_CACHE_LINE_SIZE_REG_1_ADDR A:0x4000000c
y.create.l HWIO_PCIE_0_TYPE0_BAR0_REG_1_ADDR A:0x40000010
y.create.l HWIO_PCIE_0_TYPE0_BAR1_REG_1_ADDR A:0x40000014
y.create.l HWIO_PCIE_0_TYPE0_BAR2_REG_1_ADDR A:0x40000018
y.create.l HWIO_PCIE_0_TYPE0_BAR3_REG_1_ADDR A:0x4000001c
y.create.l HWIO_PCIE_0_TYPE0_BAR4_REG_1_ADDR A:0x40000020
y.create.l HWIO_PCIE_0_TYPE0_BAR5_REG_1_ADDR A:0x40000024
y.create.l HWIO_PCIE_0_TYPE0_CARDBUS_CIS_PTR_REG_1_ADDR A:0x40000028
y.create.l HWIO_PCIE_0_TYPE0_SUBSYSTEM_ID_SUBSYSTEM_VENDOR_ID_REG_1_ADDR A:0x4000002c
y.create.l HWIO_PCIE_0_TYPE0_EXP_ROM_BASE_ADDR_REG_1_ADDR A:0x40000030
y.create.l HWIO_PCIE_0_TYPE0_PCI_CAP_PTR_REG_1_ADDR A:0x40000034
y.create.l HWIO_PCIE_0_TYPE0_MAX_LATENCY_MIN_GRANT_INTERRUPT_PIN_INTERRUPT_LINE_REG_1_ADDR A:0x4000003c
y.create.l HWIO_PCIE_0_TYPE0_L1SUB_CAP_HEADER_REG_1_ADDR A:0x40000150
y.create.l HWIO_PCIE_0_TYPE0_L1SUB_CAPABILITY_REG_1_ADDR A:0x40000154
y.create.l HWIO_PCIE_0_TYPE0_L1SUB_CONTROL1_REG_1_ADDR A:0x40000158
y.create.l HWIO_PCIE_0_TYPE0_L1SUB_CONTROL2_REG_1_ADDR A:0x4000015c
y.create.l HWIO_PCIE_0_TYPE0_CAP_ID_NXT_PTR_REG_1_ADDR A:0x40000040
y.create.l HWIO_PCIE_0_TYPE0_CON_STATUS_REG_1_ADDR A:0x40000044
y.create.l HWIO_PCIE_0_TYPE0_PCIE_CAP_ID_PCIE_NEXT_CAP_PTR_PCIE_CAP_REG_1_ADDR A:0x40000070
y.create.l HWIO_PCIE_0_TYPE0_DEVICE_CAPABILITIES_REG_1_ADDR A:0x40000074
y.create.l HWIO_PCIE_0_TYPE0_DEVICE_CONTROL_DEVICE_STATUS_1_ADDR A:0x40000078
y.create.l HWIO_PCIE_0_TYPE0_LINK_CAPABILITIES_REG_1_ADDR A:0x4000007c
y.create.l HWIO_PCIE_0_TYPE0_LINK_CONTROL_LINK_STATUS_REG_1_ADDR A:0x40000080
y.create.l HWIO_PCIE_0_TYPE0_DEVICE_CAPABILITIES2_REG_1_ADDR A:0x40000094
y.create.l HWIO_PCIE_0_TYPE0_DEVICE_CONTROL2_DEVICE_STATUS2_REG_1_ADDR A:0x40000098
y.create.l HWIO_PCIE_0_TYPE0_LINK_CAPABILITIES2_REG_1_ADDR A:0x4000009c
y.create.l HWIO_PCIE_0_TYPE0_LINK_CONTROL2_LINK_STATUS2_REG_1_ADDR A:0x400000a0
y.create.l HWIO_PCIE_0_TYPE0_AER_EXT_CAP_HDR_REG_1_ADDR A:0x40000100
y.create.l HWIO_PCIE_0_TYPE0_UNCORR_ERR_STATUS_REG_1_ADDR A:0x40000104
y.create.l HWIO_PCIE_0_TYPE0_UNCORR_ERR_MASK_REG_1_ADDR A:0x40000108
y.create.l HWIO_PCIE_0_TYPE0_UNCORR_ERR_SEV_REG_1_ADDR A:0x4000010c
y.create.l HWIO_PCIE_0_TYPE0_CORR_ERR_STATUS_REG_1_ADDR A:0x40000110
y.create.l HWIO_PCIE_0_TYPE0_CORR_ERR_MASK_REG_1_ADDR A:0x40000114
y.create.l HWIO_PCIE_0_TYPE0_ADV_ERR_CAP_CTRL_REG_1_ADDR A:0x40000118
y.create.l HWIO_PCIE_0_TYPE0_HDR_LOG_REG_0_1_ADDR A:0x4000011c
y.create.l HWIO_PCIE_0_TYPE0_HDR_LOG_REG_1_1_ADDR A:0x40000120
y.create.l HWIO_PCIE_0_TYPE0_HDR_LOG_REG_2_1_ADDR A:0x40000124
y.create.l HWIO_PCIE_0_TYPE0_HDR_LOG_REG_3_1_ADDR A:0x40000128
y.create.l HWIO_PCIE_0_TYPE0_TLP_PREFIX_LOG_REG_1_ADDR A:0x40000138
y.create.l HWIO_PCIE_0_TYPE0_PCI_MSI_CAP_ID_NEXT_CTRL_REG_1_ADDR A:0x40000050
y.create.l HWIO_PCIE_0_TYPE0_MSI_LOWER_32_1_ADDR A:0x40000054
y.create.l HWIO_PCIE_0_TYPE0_MSI_UPPER_32_1_ADDR A:0x40000058
y.create.l HWIO_PCIE_0_TYPE0_MSI_DATA_REG_1_ADDR A:0x4000005c
y.create.l HWIO_PCIE_0_TYPE0_MSI_MASK_REG_1_ADDR A:0x40000060
y.create.l HWIO_PCIE_0_TYPE0_MSI_PENDING_BIT_REG_1_ADDR A:0x40000064
y.create.l HWIO_PCIE_0_TYPE0_LTR_CAP_HDR_REG_1_ADDR A:0x40000148
y.create.l HWIO_PCIE_0_TYPE0_LTR_LATENCY_REG_1_ADDR A:0x4000014c
y.create.l HWIO_PCIE_0_TYPE0_ACK_LATENCY_TIMER_ADDR A:0x40000700
y.create.l HWIO_PCIE_0_TYPE0_VENDOR_SPEC_DLLP_REG_ADDR A:0x40000704
y.create.l HWIO_PCIE_0_TYPE0_PORT_FORCE_REG_ADDR A:0x40000708
y.create.l HWIO_PCIE_0_TYPE0_ACK_F_ASPM_CTRL_REG_ADDR A:0x4000070c
y.create.l HWIO_PCIE_0_TYPE0_PORT_LINK_CTRL_REG_ADDR A:0x40000710
y.create.l HWIO_PCIE_0_TYPE0_LANE_SKEW_REG_ADDR A:0x40000714
y.create.l HWIO_PCIE_0_TYPE0_TIMER_CTRL_MAX_FUNC_NUM_ADDR A:0x40000718
y.create.l HWIO_PCIE_0_TYPE0_SYMBOL_TIMER_FILTER_1_REG_ADDR A:0x4000071c
y.create.l HWIO_PCIE_0_TYPE0_FILTER_MASK_REG_2_ADDR A:0x40000720
y.create.l HWIO_PCIE_0_TYPE0_AMBA_MUL_OB_DECOMP_NP_SUB_REQ_CTRL_REG_ADDR A:0x40000724
y.create.l HWIO_PCIE_0_TYPE0_DEBUG_REG_0_ADDR A:0x40000728
y.create.l HWIO_PCIE_0_TYPE0_DEBUG_REG_1_ADDR A:0x4000072c
y.create.l HWIO_PCIE_0_TYPE0_TX_P_FC_CREDIT_STATUS_ADDR A:0x40000730
y.create.l HWIO_PCIE_0_TYPE0_TX_NP_FC_CREDIT_STATUS_ADDR A:0x40000734
y.create.l HWIO_PCIE_0_TYPE0_TX_CPL_FC_CREDIT_STATUS_ADDR A:0x40000738
y.create.l HWIO_PCIE_0_TYPE0_Q_STATUS_ADDR A:0x4000073c
y.create.l HWIO_PCIE_0_TYPE0_VC_TX_ARBI_REG_1_ADDR A:0x40000740
y.create.l HWIO_PCIE_0_TYPE0_VC_TX_ARBI_REG_2_ADDR A:0x40000744
y.create.l HWIO_PCIE_0_TYPE0_VC0_P_RX_Q_CTRL_ADDR A:0x40000748
y.create.l HWIO_PCIE_0_TYPE0_VC0_NP_RX_Q_CTRL_ADDR A:0x4000074c
y.create.l HWIO_PCIE_0_TYPE0_VC0_CPL_RX_Q_CTRL_ADDR A:0x40000750
y.create.l HWIO_PCIE_0_TYPE0_VC1_P_RX_Q_CTRL_ADDR A:0x40000754
y.create.l HWIO_PCIE_0_TYPE0_VC1_NP_RX_Q_CTRL_ADDR A:0x40000758
y.create.l HWIO_PCIE_0_TYPE0_VC1_CPL_RX_Q_CTRL_ADDR A:0x4000075c
y.create.l HWIO_PCIE_0_TYPE0_VC2_P_RX_Q_CTRL_ADDR A:0x40000760
y.create.l HWIO_PCIE_0_TYPE0_VC2_NP_RX_Q_CTRL_ADDR A:0x40000764
y.create.l HWIO_PCIE_0_TYPE0_VC2_CPL_RX_Q_CTRL_ADDR A:0x40000768
y.create.l HWIO_PCIE_0_TYPE0_VC3_P_RX_Q_CTRL_ADDR A:0x4000076c
y.create.l HWIO_PCIE_0_TYPE0_VC3_NP_RX_Q_CTRL_ADDR A:0x40000770
y.create.l HWIO_PCIE_0_TYPE0_VC3_CPL_RX_Q_CTRL_ADDR A:0x40000774
y.create.l HWIO_PCIE_0_TYPE0_VC4_P_RX_Q_CTRL_ADDR A:0x40000778
y.create.l HWIO_PCIE_0_TYPE0_VC4_NP_RX_Q_CTRL_ADDR A:0x4000077c
y.create.l HWIO_PCIE_0_TYPE0_VC4_CPL_RX_Q_CTRL_ADDR A:0x40000780
y.create.l HWIO_PCIE_0_TYPE0_VC5_P_RX_Q_CTRL_ADDR A:0x40000784
y.create.l HWIO_PCIE_0_TYPE0_VC5_NP_RX_Q_CTRL_ADDR A:0x40000788
y.create.l HWIO_PCIE_0_TYPE0_VC5_CPL_RX_Q_CTRL_ADDR A:0x4000078c
y.create.l HWIO_PCIE_0_TYPE0_VC6_P_RX_Q_CTRL_ADDR A:0x40000790
y.create.l HWIO_PCIE_0_TYPE0_VC6_NP_RX_Q_CTRL_ADDR A:0x40000794
y.create.l HWIO_PCIE_0_TYPE0_VC6_CPL_RX_Q_CTRL_ADDR A:0x40000798
y.create.l HWIO_PCIE_0_TYPE0_VC7_P_RX_Q_CTRL_ADDR A:0x4000079c
y.create.l HWIO_PCIE_0_TYPE0_VC7_NP_RX_Q_CTRL_ADDR A:0x400007a0
y.create.l HWIO_PCIE_0_TYPE0_VC7_CPL_RX_Q_CTRL_ADDR A:0x400007a4
y.create.l HWIO_PCIE_0_TYPE0_GEN2_CTRL_REG_ADDR A:0x4000080c
y.create.l HWIO_PCIE_0_TYPE0_PHY_STATUS_REG_ADDR A:0x40000810
y.create.l HWIO_PCIE_0_TYPE0_PHY_CONTROL_REG_ADDR A:0x40000814
y.create.l HWIO_PCIE_0_TYPE0_AXI_MASTER_CTRL_REG_0_ADDR A:0x40000818
y.create.l HWIO_PCIE_0_TYPE0_AXI_MASTER_CTRL_REG_1_ADDR A:0x4000081c
y.create.l HWIO_PCIE_0_TYPE0_MSI_CTRL_ADDR_REG_ADDR A:0x40000820
y.create.l HWIO_PCIE_0_TYPE0_MSI_CTRL_UPPER_ADDR_REG_ADDR A:0x40000824
y.create.l HWIO_PCIE_0_TYPE0_MSI_CTRL_INT_0_EN_REG_ADDR A:0x40000828
y.create.l HWIO_PCIE_0_TYPE0_MSI_CTRL_INT_0_MASK_REG_ADDR A:0x4000082c
y.create.l HWIO_PCIE_0_TYPE0_MSI_CTRL_INT_0_STATUS_REG_ADDR A:0x40000830
y.create.l HWIO_PCIE_0_TYPE0_MSI_CTRL_INT_1_EN_REG_ADDR A:0x40000834
y.create.l HWIO_PCIE_0_TYPE0_MSI_CTRL_INT_1_MASK_REG_ADDR A:0x40000838
y.create.l HWIO_PCIE_0_TYPE0_MSI_CTRL_INT_1_STATUS_REG_ADDR A:0x4000083c
y.create.l HWIO_PCIE_0_TYPE0_MSI_CTRL_INT_2_EN_REG_ADDR A:0x40000840
y.create.l HWIO_PCIE_0_TYPE0_MSI_CTRL_INT_2_MASK_REG_ADDR A:0x40000844
y.create.l HWIO_PCIE_0_TYPE0_MSI_CTRL_INT_2_STATUS_REG_ADDR A:0x40000848
y.create.l HWIO_PCIE_0_TYPE0_MSI_CTRL_INT_3_EN_REG_ADDR A:0x4000084c
y.create.l HWIO_PCIE_0_TYPE0_MSI_CTRL_INT_3_MASK_REG_ADDR A:0x40000850
y.create.l HWIO_PCIE_0_TYPE0_MSI_CTRL_INT_3_STATUS_REG_ADDR A:0x40000854
y.create.l HWIO_PCIE_0_TYPE0_MSI_CTRL_INT_4_EN_REG_ADDR A:0x40000858
y.create.l HWIO_PCIE_0_TYPE0_MSI_CTRL_INT_4_MASK_REG_ADDR A:0x4000085c
y.create.l HWIO_PCIE_0_TYPE0_MSI_CTRL_INT_4_STATUS_REG_ADDR A:0x40000860
y.create.l HWIO_PCIE_0_TYPE0_MSI_CTRL_INT_5_EN_REG_ADDR A:0x40000864
y.create.l HWIO_PCIE_0_TYPE0_MSI_CTRL_INT_5_MASK_REG_ADDR A:0x40000868
y.create.l HWIO_PCIE_0_TYPE0_MSI_CTRL_INT_5_STATUS_REG_ADDR A:0x4000086c
y.create.l HWIO_PCIE_0_TYPE0_MSI_CTRL_INT_6_EN_REG_ADDR A:0x40000870
y.create.l HWIO_PCIE_0_TYPE0_MSI_CTRL_INT_6_MASK_REG_ADDR A:0x40000874
y.create.l HWIO_PCIE_0_TYPE0_MSI_CTRL_INT_6_STATUS_REG_ADDR A:0x40000878
y.create.l HWIO_PCIE_0_TYPE0_MSI_CTRL_INT_7_EN_REG_ADDR A:0x4000087c
y.create.l HWIO_PCIE_0_TYPE0_MSI_CTRL_INT_7_MASK_REG_ADDR A:0x40000880
y.create.l HWIO_PCIE_0_TYPE0_MSI_CTRL_INT_7_STATUS_REG_ADDR A:0x40000884
y.create.l HWIO_PCIE_0_TYPE0_MSI_GPIO_IO_REG_ADDR A:0x40000888
y.create.l HWIO_PCIE_0_TYPE0_GEN3_RELATED_REG_ADDR A:0x40000890
y.create.l HWIO_PCIE_0_TYPE0_GEN3_EQ_LOCAL_FS_LF_REG_ADDR A:0x40000894
y.create.l HWIO_PCIE_0_TYPE0_GEN3_EQ_PSET_COEF_MAP_0_ADDR A:0x40000898
y.create.l HWIO_PCIE_0_TYPE0_GEN3_EQ_PSET_INDEX_REG_ADDR A:0x4000089c
y.create.l HWIO_PCIE_0_TYPE0_PF_HIDDEN_REG_ADDR A:0x400008a0
y.create.l HWIO_PCIE_0_TYPE0_GEN3_EQ_COEFF_LEGALITY_STATUS_REG_ADDR A:0x400008a4
y.create.l HWIO_PCIE_0_TYPE0_GEN3_EQ_CONTROL_REG_ADDR A:0x400008a8
y.create.l HWIO_PCIE_0_TYPE0_GEN3_EQ_FB_MODE_DIR_CHANGE_REG_ADDR A:0x400008ac
y.create.l HWIO_PCIE_0_TYPE0_PIPE_LOOPBACK_CONTROL_ADDR A:0x400008b8
y.create.l HWIO_PCIE_0_TYPE0_MISC_CONTROL_1_REG_ADDR A:0x400008bc
y.create.l HWIO_PCIE_0_TYPE0_AMBA_ERROR_RESPONSE_DEFAULT_REG_ADDR A:0x400008d0
y.create.l HWIO_PCIE_0_TYPE0_AMBA_ORDERING_CTRL_OFF_ADDR A:0x400008d8
y.create.l HWIO_PCIE_0_TYPE0_PL_LAST_REG_ADDR A:0x400008fc
y.create.l HWIO_PCIE_0_TYPE0_IATU_VIEWPORT_REG_ADDR A:0x40000900
y.create.l HWIO_PCIE_0_TYPE0_PL_IATU_REGION_CTRL_REG_1_OUTBOUND_0_ADDR A:0x40000904
y.create.l HWIO_PCIE_0_TYPE0_PL_IATU_REGION_CTRL_REG_2_OUTBOUND_0_ADDR A:0x40000908
y.create.l HWIO_PCIE_0_TYPE0_PL_IATU_LWR_BASE_ADDR_REG_OUTBOUND_0_ADDR A:0x4000090c
y.create.l HWIO_PCIE_0_TYPE0_PL_IATU_UPPER_BASE_ADDR_REG_OUTBOUND_0_ADDR A:0x40000910
y.create.l HWIO_PCIE_0_TYPE0_PL_IATU_LIMIT_ADDR_REG_OUTBOUND_0_ADDR A:0x40000914
y.create.l HWIO_PCIE_0_TYPE0_PL_IATU_LWR_TARGET_ADDR_REG_OUTBOUND_0_ADDR A:0x40000918
y.create.l HWIO_PCIE_0_TYPE0_PL_IATU_UPPER_TARGET_ADDR_REG_OUTBOUND_0_ADDR A:0x4000091c
y.create.l HWIO_PCIE_0_TYPE0_PL_IATU_REGION_CTRL_REG_3_OUTBOUND_0_ADDR A:0x40000920
y.create.l HWIO_PCIE_0_TYPE0_DMA_CTRL_REG_ADDR A:0x40000978
y.create.l HWIO_PCIE_0_TYPE0_DMA_WRITE_ENGINE_EN_ADDR A:0x4000097c
y.create.l HWIO_PCIE_0_TYPE0_DMA_WRITE_DOORBELL_REG_ADDR A:0x40000980
y.create.l HWIO_PCIE_0_TYPE0_DMA_WRITE_CHANNEL_ARB_WEIGHT_LOW_REG_ADDR A:0x40000988
y.create.l HWIO_PCIE_0_TYPE0_DMA_WRITE_CHANNEL_ARB_WEIGHT_HIGH_REG_ADDR A:0x4000098c
y.create.l HWIO_PCIE_0_TYPE0_DMA_WRITE_P_REQ_TIMER_REG_ADDR A:0x40000998
y.create.l HWIO_PCIE_0_TYPE0_DMA_READ_ENGINE_EN_ADDR A:0x4000099c
y.create.l HWIO_PCIE_0_TYPE0_DMA_READ_DOORBELL_REG_ADDR A:0x400009a0
y.create.l HWIO_PCIE_0_TYPE0_DMA_READ_CHANNEL_ARB_WEIGHT_LOW_REG_ADDR A:0x400009a8
y.create.l HWIO_PCIE_0_TYPE0_DMA_READ_CHANNEL_ARB_WEIGHT_HIGH_REG_ADDR A:0x400009ac
y.create.l HWIO_PCIE_0_TYPE0_DMA_WRITE_INT_STATUS_REG_ADDR A:0x400009bc
y.create.l HWIO_PCIE_0_TYPE0_DMA_WRITE_INT_MASK_REG_ADDR A:0x400009c4
y.create.l HWIO_PCIE_0_TYPE0_DMA_WRITE_INT_CLEAR_REG_ADDR A:0x400009c8
y.create.l HWIO_PCIE_0_TYPE0_DMA_WRITE_ERR_STATUS_REG_ADDR A:0x400009cc
y.create.l HWIO_PCIE_0_TYPE0_DMA_WRITE_DONE_IMWR_LOW_REG_ADDR A:0x400009d0
y.create.l HWIO_PCIE_0_TYPE0_DMA_WRITE_DONE_IMWR_HIGH_REG_ADDR A:0x400009d4
y.create.l HWIO_PCIE_0_TYPE0_DMA_WRITE_ABORT_IMWR_LOW_REG_ADDR A:0x400009d8
y.create.l HWIO_PCIE_0_TYPE0_DMA_WRITE_ABORT_IMWR_HIGH_REG_ADDR A:0x400009dc
y.create.l HWIO_PCIE_0_TYPE0_DMA_WRITE_CH01_IMWR_DATA_REG_ADDR A:0x400009e0
y.create.l HWIO_PCIE_0_TYPE0_DMA_WRITE_LINKED_LIST_ERR_EN_REG_ADDR A:0x40000a00
y.create.l HWIO_PCIE_0_TYPE0_DMA_READ_INT_STATUS_REG_ADDR A:0x40000a10
y.create.l HWIO_PCIE_0_TYPE0_DMA_READ_INT_MASK_REG_ADDR A:0x40000a18
y.create.l HWIO_PCIE_0_TYPE0_DMA_READ_INT_CLEAR_REG_ADDR A:0x40000a1c
y.create.l HWIO_PCIE_0_TYPE0_DMA_READ_ERR_STATUS_LOW_REG_ADDR A:0x40000a24
y.create.l HWIO_PCIE_0_TYPE0_DMA_READ_ERR_STATUS_HIGH_REG_ADDR A:0x40000a28
y.create.l HWIO_PCIE_0_TYPE0_DMA_READ_LINKED_LIST_ERR_EN_REG_ADDR A:0x40000a34
y.create.l HWIO_PCIE_0_TYPE0_DMA_READ_DONE_IMWR_LOW_REG_ADDR A:0x40000a3c
y.create.l HWIO_PCIE_0_TYPE0_DMA_READ_DONE_IMWR_HIGH_REG_ADDR A:0x40000a40
y.create.l HWIO_PCIE_0_TYPE0_DMA_READ_ABORT_IMWR_LOW_REG_ADDR A:0x40000a44
y.create.l HWIO_PCIE_0_TYPE0_DMA_READ_ABORT_IMWR_HIGH_REG_ADDR A:0x40000a48
y.create.l HWIO_PCIE_0_TYPE0_DMA_READ_CH01_IMWR_DATA_REG_ADDR A:0x40000a4c
y.create.l HWIO_PCIE_0_TYPE0_DMA_VIEWPORT_SEL_REG_ADDR A:0x40000a6c
y.create.l HWIO_PCIE_0_TYPE0_DMA_CH_CONTROL1_REG_WRCH_0_ADDR A:0x40000a70
y.create.l HWIO_PCIE_0_TYPE0_DMA_CH_CONTROL2_REG_WRCH_0_ADDR A:0x40000a74
y.create.l HWIO_PCIE_0_TYPE0_DMA_TRANSFER_SIZE_REG_WRCH_0_ADDR A:0x40000a78
y.create.l HWIO_PCIE_0_TYPE0_DMA_SAR_LOW_REG_WRCH_0_ADDR A:0x40000a7c
y.create.l HWIO_PCIE_0_TYPE0_DMA_SAR_HIGH_REG_WRCH_0_ADDR A:0x40000a80
y.create.l HWIO_PCIE_0_TYPE0_DMA_DAR_LOW_REG_WRCH_0_ADDR A:0x40000a84
y.create.l HWIO_PCIE_0_TYPE0_DMA_DAR_HIGH_REG_WRCH_0_ADDR A:0x40000a88
y.create.l HWIO_PCIE_0_TYPE0_DMA_LLP_LOW_REG_WRCH_0_ADDR A:0x40000a8c
y.create.l HWIO_PCIE_0_TYPE0_DMA_LLP_HIGH_REG_WRCH_0_ADDR A:0x40000a90
y.create.l HWIO_PCIE_0_TYPE0_PL_LTR_LATENCY_REG_ADDR A:0x40000b30
y.create.l HWIO_PCIE_0_TYPE0_AUX_CLK_FREQ_REG_ADDR A:0x40000b40
y.create.l HWIO_PCIE_0_TYPE0_L1_SUBSTATES_REG_ADDR A:0x40000b44
y.create.l HWIO_PCIE_0_PCIE20_ELBI_VERSION_ADDR A:0x40000f20
y.create.l HWIO_PCIE_0_PCIE20_ELBI_SYS_CTRL_ADDR A:0x40000f24
y.create.l HWIO_PCIE_0_PCIE20_ELBI_SYS_STTS_ADDR A:0x40000f28
y.create.l HWIO_PCIE_0_PCIE20_ELBI_SYS_CLR_ADDR A:0x40000f2c
y.create.l HWIO_PCIE_0_PCIE20_ELBI_TESTBUS_CTRL_ADDR A:0x40000f40
y.create.l HWIO_PCIE_0_PCIE20_ELBI_DEBUG_INFO_0_ADDR A:0x40000f50
y.create.l HWIO_PCIE_0_PCIE20_ELBI_DEBUG_INFO_1_ADDR A:0x40000f54
y.create.l HWIO_PCIE_0_PCIE20_ELBI_TB_DIAG_0_ADDR A:0x40000f60
y.create.l HWIO_PCIE_0_PCIE20_ELBI_TB_DIAG_1_ADDR A:0x40000f64
y.create.l HWIO_PCIE_0_PCIE20_ELBI_TB_DIAG_2_ADDR A:0x40000f68
y.create.l HWIO_PCIE_0_PCIE20_ELBI_TB_DIAG_3_ADDR A:0x40000f6c
y.create.l HWIO_PCIE_0_PCIE20_ELBI_TB_DIAG_4_ADDR A:0x40000f70
y.create.l HWIO_PCIE_0_PCIE20_ELBI_TB_DIAG_5_ADDR A:0x40000f74
y.create.l HWIO_PCIE_0_PCIE20_ELBI_TB_DIAG_6_ADDR A:0x40000f78
y.create.l HWIO_PCIE_0_PCIE20_ELBI_TB_DIAG_7_ADDR A:0x40000f7c
y.create.l HWIO_PCIE_0_PCIE20_ELBI_TB_DIAG_8_ADDR A:0x40000f80
y.create.l HWIO_PCIE_0_PCIE20_ELBI_TB_DIAG_9_ADDR A:0x40000f84
y.create.l HWIO_PCIE_0_PCIE20_ELBI_DEBUG_INFO_EI_ADDR A:0x40000fc0
y.create.l HWIO_PCIE_0_PCIE20_ELBI_CS2_ENABLE_ADDR A:0x40000fc4
y.create.l HWIO_PCNOC_0_ABT_HW_VERSION_ADDR A:0x60023000
y.create.l HWIO_PCNOC_0_ABT_INST_ID_ADDR A:0x60023004
y.create.l HWIO_PCNOC_0_ABT_NUM_SLAVES_ADDR A:0x60023008
y.create.l HWIO_PCNOC_0_ABT_TIMER_LOADVAL_ADDR A:0x6002300c
y.create.l HWIO_PCNOC_0_ABT_TIMER_MODE_ADDR A:0x60023010
y.create.l HWIO_PCNOC_0_ABT_INTR_STATUS_ADDR A:0x60023014
y.create.l HWIO_PCNOC_0_ABT_INTR_CLEAR_ADDR A:0x60023018
y.create.l HWIO_PCNOC_0_ABT_INTR_ENABLE_ADDR A:0x6002301c
y.create.l HWIO_PCNOC_0_ABT_SYND_VALID_ADDR A:0x60023020
y.create.l HWIO_PCNOC_0_ABT_SYND_CLEAR_ADDR A:0x60023024
y.create.l HWIO_PCNOC_0_ABT_SYND_ID_ADDR A:0x60023028
y.create.l HWIO_PCNOC_0_ABT_SYND_ADDR0_ADDR A:0x6002302c
y.create.l HWIO_PCNOC_0_ABT_SYND_ADDR1_ADDR A:0x60023030
y.create.l HWIO_PCNOC_0_ABT_SYND_HREADY_ADDR A:0x60023034
y.create.l HWIO_PCNOC_1_ABT_HW_VERSION_ADDR A:0x60024000
y.create.l HWIO_PCNOC_1_ABT_INST_ID_ADDR A:0x60024004
y.create.l HWIO_PCNOC_1_ABT_NUM_SLAVES_ADDR A:0x60024008
y.create.l HWIO_PCNOC_1_ABT_TIMER_LOADVAL_ADDR A:0x6002400c
y.create.l HWIO_PCNOC_1_ABT_TIMER_MODE_ADDR A:0x60024010
y.create.l HWIO_PCNOC_1_ABT_INTR_STATUS_ADDR A:0x60024014
y.create.l HWIO_PCNOC_1_ABT_INTR_CLEAR_ADDR A:0x60024018
y.create.l HWIO_PCNOC_1_ABT_INTR_ENABLE_ADDR A:0x6002401c
y.create.l HWIO_PCNOC_1_ABT_SYND_VALID_ADDR A:0x60024020
y.create.l HWIO_PCNOC_1_ABT_SYND_CLEAR_ADDR A:0x60024024
y.create.l HWIO_PCNOC_1_ABT_SYND_ID_ADDR A:0x60024028
y.create.l HWIO_PCNOC_1_ABT_SYND_ADDR0_ADDR A:0x6002402c
y.create.l HWIO_PCNOC_1_ABT_SYND_ADDR1_ADDR A:0x60024030
y.create.l HWIO_PCNOC_1_ABT_SYND_HREADY_ADDR A:0x60024034
y.create.l HWIO_PCNOC_2_ABT_HW_VERSION_ADDR A:0x60025000
y.create.l HWIO_PCNOC_2_ABT_INST_ID_ADDR A:0x60025004
y.create.l HWIO_PCNOC_2_ABT_NUM_SLAVES_ADDR A:0x60025008
y.create.l HWIO_PCNOC_2_ABT_TIMER_LOADVAL_ADDR A:0x6002500c
y.create.l HWIO_PCNOC_2_ABT_TIMER_MODE_ADDR A:0x60025010
y.create.l HWIO_PCNOC_2_ABT_INTR_STATUS_ADDR A:0x60025014
y.create.l HWIO_PCNOC_2_ABT_INTR_CLEAR_ADDR A:0x60025018
y.create.l HWIO_PCNOC_2_ABT_INTR_ENABLE_ADDR A:0x6002501c
y.create.l HWIO_PCNOC_2_ABT_SYND_VALID_ADDR A:0x60025020
y.create.l HWIO_PCNOC_2_ABT_SYND_CLEAR_ADDR A:0x60025024
y.create.l HWIO_PCNOC_2_ABT_SYND_ID_ADDR A:0x60025028
y.create.l HWIO_PCNOC_2_ABT_SYND_ADDR0_ADDR A:0x6002502c
y.create.l HWIO_PCNOC_2_ABT_SYND_ADDR1_ADDR A:0x60025030
y.create.l HWIO_PCNOC_2_ABT_SYND_HREADY_ADDR A:0x60025034
y.create.l HWIO_PCNOC_3_ABT_HW_VERSION_ADDR A:0x60026000
y.create.l HWIO_PCNOC_3_ABT_INST_ID_ADDR A:0x60026004
y.create.l HWIO_PCNOC_3_ABT_NUM_SLAVES_ADDR A:0x60026008
y.create.l HWIO_PCNOC_3_ABT_TIMER_LOADVAL_ADDR A:0x6002600c
y.create.l HWIO_PCNOC_3_ABT_TIMER_MODE_ADDR A:0x60026010
y.create.l HWIO_PCNOC_3_ABT_INTR_STATUS_ADDR A:0x60026014
y.create.l HWIO_PCNOC_3_ABT_INTR_CLEAR_ADDR A:0x60026018
y.create.l HWIO_PCNOC_3_ABT_INTR_ENABLE_ADDR A:0x6002601c
y.create.l HWIO_PCNOC_3_ABT_SYND_VALID_ADDR A:0x60026020
y.create.l HWIO_PCNOC_3_ABT_SYND_CLEAR_ADDR A:0x60026024
y.create.l HWIO_PCNOC_3_ABT_SYND_ID_ADDR A:0x60026028
y.create.l HWIO_PCNOC_3_ABT_SYND_ADDR0_ADDR A:0x6002602c
y.create.l HWIO_PCNOC_3_ABT_SYND_ADDR1_ADDR A:0x60026030
y.create.l HWIO_PCNOC_3_ABT_SYND_HREADY_ADDR A:0x60026034
y.create.l HWIO_PCNOC_4_ABT_HW_VERSION_ADDR A:0x60027000
y.create.l HWIO_PCNOC_4_ABT_INST_ID_ADDR A:0x60027004
y.create.l HWIO_PCNOC_4_ABT_NUM_SLAVES_ADDR A:0x60027008
y.create.l HWIO_PCNOC_4_ABT_TIMER_LOADVAL_ADDR A:0x6002700c
y.create.l HWIO_PCNOC_4_ABT_TIMER_MODE_ADDR A:0x60027010
y.create.l HWIO_PCNOC_4_ABT_INTR_STATUS_ADDR A:0x60027014
y.create.l HWIO_PCNOC_4_ABT_INTR_CLEAR_ADDR A:0x60027018
y.create.l HWIO_PCNOC_4_ABT_INTR_ENABLE_ADDR A:0x6002701c
y.create.l HWIO_PCNOC_4_ABT_SYND_VALID_ADDR A:0x60027020
y.create.l HWIO_PCNOC_4_ABT_SYND_CLEAR_ADDR A:0x60027024
y.create.l HWIO_PCNOC_4_ABT_SYND_ID_ADDR A:0x60027028
y.create.l HWIO_PCNOC_4_ABT_SYND_ADDR0_ADDR A:0x6002702c
y.create.l HWIO_PCNOC_4_ABT_SYND_ADDR1_ADDR A:0x60027030
y.create.l HWIO_PCNOC_4_ABT_SYND_HREADY_ADDR A:0x60027034
y.create.l HWIO_PCNOC_5_ABT_HW_VERSION_ADDR A:0x60028000
y.create.l HWIO_PCNOC_5_ABT_INST_ID_ADDR A:0x60028004
y.create.l HWIO_PCNOC_5_ABT_NUM_SLAVES_ADDR A:0x60028008
y.create.l HWIO_PCNOC_5_ABT_TIMER_LOADVAL_ADDR A:0x6002800c
y.create.l HWIO_PCNOC_5_ABT_TIMER_MODE_ADDR A:0x60028010
y.create.l HWIO_PCNOC_5_ABT_INTR_STATUS_ADDR A:0x60028014
y.create.l HWIO_PCNOC_5_ABT_INTR_CLEAR_ADDR A:0x60028018
y.create.l HWIO_PCNOC_5_ABT_INTR_ENABLE_ADDR A:0x6002801c
y.create.l HWIO_PCNOC_5_ABT_SYND_VALID_ADDR A:0x60028020
y.create.l HWIO_PCNOC_5_ABT_SYND_CLEAR_ADDR A:0x60028024
y.create.l HWIO_PCNOC_5_ABT_SYND_ID_ADDR A:0x60028028
y.create.l HWIO_PCNOC_5_ABT_SYND_ADDR0_ADDR A:0x6002802c
y.create.l HWIO_PCNOC_5_ABT_SYND_ADDR1_ADDR A:0x60028030
y.create.l HWIO_PCNOC_5_ABT_SYND_HREADY_ADDR A:0x60028034
y.create.l HWIO_PCNOC_6_ABT_HW_VERSION_ADDR A:0x60029000
y.create.l HWIO_PCNOC_6_ABT_INST_ID_ADDR A:0x60029004
y.create.l HWIO_PCNOC_6_ABT_NUM_SLAVES_ADDR A:0x60029008
y.create.l HWIO_PCNOC_6_ABT_TIMER_LOADVAL_ADDR A:0x6002900c
y.create.l HWIO_PCNOC_6_ABT_TIMER_MODE_ADDR A:0x60029010
y.create.l HWIO_PCNOC_6_ABT_INTR_STATUS_ADDR A:0x60029014
y.create.l HWIO_PCNOC_6_ABT_INTR_CLEAR_ADDR A:0x60029018
y.create.l HWIO_PCNOC_6_ABT_INTR_ENABLE_ADDR A:0x6002901c
y.create.l HWIO_PCNOC_6_ABT_SYND_VALID_ADDR A:0x60029020
y.create.l HWIO_PCNOC_6_ABT_SYND_CLEAR_ADDR A:0x60029024
y.create.l HWIO_PCNOC_6_ABT_SYND_ID_ADDR A:0x60029028
y.create.l HWIO_PCNOC_6_ABT_SYND_ADDR0_ADDR A:0x6002902c
y.create.l HWIO_PCNOC_6_ABT_SYND_ADDR1_ADDR A:0x60029030
y.create.l HWIO_PCNOC_6_ABT_SYND_HREADY_ADDR A:0x60029034
y.create.l HWIO_PCNOC_7_ABT_HW_VERSION_ADDR A:0x6002a000
y.create.l HWIO_PCNOC_7_ABT_INST_ID_ADDR A:0x6002a004
y.create.l HWIO_PCNOC_7_ABT_NUM_SLAVES_ADDR A:0x6002a008
y.create.l HWIO_PCNOC_7_ABT_TIMER_LOADVAL_ADDR A:0x6002a00c
y.create.l HWIO_PCNOC_7_ABT_TIMER_MODE_ADDR A:0x6002a010
y.create.l HWIO_PCNOC_7_ABT_INTR_STATUS_ADDR A:0x6002a014
y.create.l HWIO_PCNOC_7_ABT_INTR_CLEAR_ADDR A:0x6002a018
y.create.l HWIO_PCNOC_7_ABT_INTR_ENABLE_ADDR A:0x6002a01c
y.create.l HWIO_PCNOC_7_ABT_SYND_VALID_ADDR A:0x6002a020
y.create.l HWIO_PCNOC_7_ABT_SYND_CLEAR_ADDR A:0x6002a024
y.create.l HWIO_PCNOC_7_ABT_SYND_ID_ADDR A:0x6002a028
y.create.l HWIO_PCNOC_7_ABT_SYND_ADDR0_ADDR A:0x6002a02c
y.create.l HWIO_PCNOC_7_ABT_SYND_ADDR1_ADDR A:0x6002a030
y.create.l HWIO_PCNOC_7_ABT_SYND_HREADY_ADDR A:0x6002a034
y.create.l HWIO_PCNOC_8_ABT_HW_VERSION_ADDR A:0x6002b000
y.create.l HWIO_PCNOC_8_ABT_INST_ID_ADDR A:0x6002b004
y.create.l HWIO_PCNOC_8_ABT_NUM_SLAVES_ADDR A:0x6002b008
y.create.l HWIO_PCNOC_8_ABT_TIMER_LOADVAL_ADDR A:0x6002b00c
y.create.l HWIO_PCNOC_8_ABT_TIMER_MODE_ADDR A:0x6002b010
y.create.l HWIO_PCNOC_8_ABT_INTR_STATUS_ADDR A:0x6002b014
y.create.l HWIO_PCNOC_8_ABT_INTR_CLEAR_ADDR A:0x6002b018
y.create.l HWIO_PCNOC_8_ABT_INTR_ENABLE_ADDR A:0x6002b01c
y.create.l HWIO_PCNOC_8_ABT_SYND_VALID_ADDR A:0x6002b020
y.create.l HWIO_PCNOC_8_ABT_SYND_CLEAR_ADDR A:0x6002b024
y.create.l HWIO_PCNOC_8_ABT_SYND_ID_ADDR A:0x6002b028
y.create.l HWIO_PCNOC_8_ABT_SYND_ADDR0_ADDR A:0x6002b02c
y.create.l HWIO_PCNOC_8_ABT_SYND_ADDR1_ADDR A:0x6002b030
y.create.l HWIO_PCNOC_8_ABT_SYND_HREADY_ADDR A:0x6002b034
y.create.l HWIO_PCNOC_OBS_ID_COREID_ADDR A:0x60500000
y.create.l HWIO_PCNOC_OBS_ID_REVISIONID_ADDR A:0x60500004
y.create.l HWIO_PCNOC_OBS_FAULTEN_ADDR A:0x60500008
y.create.l HWIO_PCNOC_OBS_ERRVLD_ADDR A:0x6050000c
y.create.l HWIO_PCNOC_OBS_ERRCLR_ADDR A:0x60500010
y.create.l HWIO_PCNOC_OBS_ERRLOG0_ADDR A:0x60500014
y.create.l HWIO_PCNOC_OBS_ERRLOG1_ADDR A:0x60500018
y.create.l HWIO_PCNOC_OBS_ERRLOG3_ADDR A:0x60500020
y.create.l HWIO_PCNOC_OBS_ERRLOG4_ADDR A:0x60500024
y.create.l HWIO_PCNOC_OBS_ERRLOG5_ADDR A:0x60500028
y.create.l HWIO_PCNOC_OBS_DBG_ID_COREID_ADDR A:0x60500080
y.create.l HWIO_PCNOC_OBS_DBG_ID_REVISIONID_ADDR A:0x60500084
y.create.l HWIO_PCNOC_OBS_DBG_ATBID_ADDR A:0x60500088
y.create.l HWIO_PCNOC_OBS_DBG_ATBEN_ADDR A:0x6050008c
y.create.l HWIO_PCNOC_OBS_DBG_SYNCPERIOD_ADDR A:0x60500090
y.create.l HWIO_PCNOC_QXM_CRYPTO0_TFILT_ID_COREID_ADDR A:0x60501000
y.create.l HWIO_PCNOC_QXM_CRYPTO0_TFILT_ID_REVISIONID_ADDR A:0x60501004
y.create.l HWIO_PCNOC_QXM_CRYPTO0_TFILT_MODE_ADDR A:0x60501008
y.create.l HWIO_PCNOC_QXM_CRYPTO0_TFILT_ADDRBASE_LOW_ADDR A:0x6050100c
y.create.l HWIO_PCNOC_QXM_CRYPTO0_TFILT_ADDRBASE_HIGH_ADDR A:0x60501010
y.create.l HWIO_PCNOC_QXM_CRYPTO0_TFILT_ADDRWINDOWSIZE_ADDR A:0x60501014
y.create.l HWIO_PCNOC_QXM_CRYPTO0_TFILT_SRCIDBASE_ADDR A:0x60501018
y.create.l HWIO_PCNOC_QXM_CRYPTO0_TFILT_SRCIDMASK_ADDR A:0x6050101c
y.create.l HWIO_PCNOC_QXM_CRYPTO0_TFILT_OPCODE_ADDR A:0x60501020
y.create.l HWIO_PCNOC_QXM_CRYPTO0_TFILT_USERBASE_ADDR A:0x60501024
y.create.l HWIO_PCNOC_QXM_CRYPTO0_TFILT_USERMASK_ADDR A:0x60501028
y.create.l HWIO_PCNOC_QXM_SDC1_TFILT_ID_COREID_ADDR A:0x60501080
y.create.l HWIO_PCNOC_QXM_SDC1_TFILT_ID_REVISIONID_ADDR A:0x60501084
y.create.l HWIO_PCNOC_QXM_SDC1_TFILT_MODE_ADDR A:0x60501088
y.create.l HWIO_PCNOC_QXM_SDC1_TFILT_ADDRBASE_LOW_ADDR A:0x6050108c
y.create.l HWIO_PCNOC_QXM_SDC1_TFILT_ADDRWINDOWSIZE_ADDR A:0x60501094
y.create.l HWIO_PCNOC_QXM_SDC1_TFILT_SRCIDBASE_ADDR A:0x60501098
y.create.l HWIO_PCNOC_QXM_SDC1_TFILT_SRCIDMASK_ADDR A:0x6050109c
y.create.l HWIO_PCNOC_QXM_SDC1_TFILT_OPCODE_ADDR A:0x605010a0
y.create.l HWIO_PCNOC_QXM_SDC1_TFILT_USERBASE_ADDR A:0x605010a4
y.create.l HWIO_PCNOC_QXM_SDC1_TFILT_USERMASK_ADDR A:0x605010a8
y.create.l HWIO_PCNOC_QHM2_TFILT_ID_COREID_ADDR A:0x60501180
y.create.l HWIO_PCNOC_QHM2_TFILT_ID_REVISIONID_ADDR A:0x60501184
y.create.l HWIO_PCNOC_QHM2_TFILT_MODE_ADDR A:0x60501188
y.create.l HWIO_PCNOC_QHM2_TFILT_ADDRBASE_LOW_ADDR A:0x6050118c
y.create.l HWIO_PCNOC_QHM2_TFILT_ADDRWINDOWSIZE_ADDR A:0x60501194
y.create.l HWIO_PCNOC_QHM2_TFILT_SRCIDBASE_ADDR A:0x60501198
y.create.l HWIO_PCNOC_QHM2_TFILT_SRCIDMASK_ADDR A:0x6050119c
y.create.l HWIO_PCNOC_QHM2_TFILT_OPCODE_ADDR A:0x605011a0
y.create.l HWIO_PCNOC_QHM2_TFILT_USERBASE_ADDR A:0x605011a4
y.create.l HWIO_PCNOC_QHM2_TFILT_USERMASK_ADDR A:0x605011a8
y.create.l HWIO_PCNOC_QHM1_TFILT_ID_COREID_ADDR A:0x60501200
y.create.l HWIO_PCNOC_QHM1_TFILT_ID_REVISIONID_ADDR A:0x60501204
y.create.l HWIO_PCNOC_QHM1_TFILT_MODE_ADDR A:0x60501208
y.create.l HWIO_PCNOC_QHM1_TFILT_ADDRBASE_LOW_ADDR A:0x6050120c
y.create.l HWIO_PCNOC_QHM1_TFILT_ADDRWINDOWSIZE_ADDR A:0x60501214
y.create.l HWIO_PCNOC_QHM1_TFILT_SRCIDBASE_ADDR A:0x60501218
y.create.l HWIO_PCNOC_QHM1_TFILT_SRCIDMASK_ADDR A:0x6050121c
y.create.l HWIO_PCNOC_QHM1_TFILT_OPCODE_ADDR A:0x60501220
y.create.l HWIO_PCNOC_QHM1_TFILT_USERBASE_ADDR A:0x60501224
y.create.l HWIO_PCNOC_QHM1_TFILT_USERMASK_ADDR A:0x60501228
y.create.l HWIO_PCNOC_QXM_SNOC_TFILT_ID_COREID_ADDR A:0x60501280
y.create.l HWIO_PCNOC_QXM_SNOC_TFILT_ID_REVISIONID_ADDR A:0x60501284
y.create.l HWIO_PCNOC_QXM_SNOC_TFILT_MODE_ADDR A:0x60501288
y.create.l HWIO_PCNOC_QXM_SNOC_TFILT_ADDRBASE_LOW_ADDR A:0x6050128c
y.create.l HWIO_PCNOC_QXM_SNOC_TFILT_ADDRBASE_HIGH_ADDR A:0x60501290
y.create.l HWIO_PCNOC_QXM_SNOC_TFILT_ADDRWINDOWSIZE_ADDR A:0x60501294
y.create.l HWIO_PCNOC_QXM_SNOC_TFILT_SRCIDBASE_ADDR A:0x60501298
y.create.l HWIO_PCNOC_QXM_SNOC_TFILT_SRCIDMASK_ADDR A:0x6050129c
y.create.l HWIO_PCNOC_QXM_SNOC_TFILT_OPCODE_ADDR A:0x605012a0
y.create.l HWIO_PCNOC_QXM_SNOC_TFILT_USERBASE_ADDR A:0x605012a4
y.create.l HWIO_PCNOC_QXM_SNOC_TFILT_USERMASK_ADDR A:0x605012a8
y.create.l HWIO_PCNOC_TPRB0_TPROF_ID_COREID_ADDR A:0x60502000
y.create.l HWIO_PCNOC_TPRB0_TPROF_ID_REVISIONID_ADDR A:0x60502004
y.create.l HWIO_PCNOC_TPRB0_TPROF_EN_ADDR A:0x60502008
y.create.l HWIO_PCNOC_TPRB0_TPROF_MODE_ADDR A:0x6050200c
y.create.l HWIO_PCNOC_TPRB0_TPROF_OBSERVEDSEL_0_ADDR A:0x60502010
y.create.l HWIO_PCNOC_TPRB0_TPROF_OBSERVEDSEL_1_ADDR A:0x60502014
y.create.l HWIO_PCNOC_TPRB0_TPROF_NTENURELINES_0_ADDR A:0x60502020
y.create.l HWIO_PCNOC_TPRB0_TPROF_THRESHOLDS_0_0_ADDR A:0x6050202c
y.create.l HWIO_PCNOC_TPRB0_TPROF_THRESHOLDS_0_1_ADDR A:0x60502030
y.create.l HWIO_PCNOC_TPRB0_TPROF_THRESHOLDS_0_2_ADDR A:0x60502034
y.create.l HWIO_PCNOC_TPRB0_TPROF_THRESHOLDS_1_0_ADDR A:0x6050203c
y.create.l HWIO_PCNOC_TPRB0_TPROF_THRESHOLDS_1_1_ADDR A:0x60502040
y.create.l HWIO_PCNOC_TPRB0_TPROF_THRESHOLDS_1_2_ADDR A:0x60502044
y.create.l HWIO_PCNOC_TPRB0_TPROF_OVERFLOWSTATUS_ADDR A:0x6050206c
y.create.l HWIO_PCNOC_TPRB0_TPROF_OVERFLOWRESET_ADDR A:0x60502070
y.create.l HWIO_PCNOC_TPRB0_TPROF_PENDINGEVENTMODE_ADDR A:0x60502074
y.create.l HWIO_PCNOC_TPRB0_TPROF_PRESCALER_ADDR A:0x60502078
y.create.l HWIO_PCNOC_EPRB0_SPROF_ID_COREID_ADDR A:0x60503000
y.create.l HWIO_PCNOC_EPRB0_SPROF_ID_REVISIONID_ADDR A:0x60503004
y.create.l HWIO_PCNOC_EPRB0_SPROF_MAINCTL_ADDR A:0x60503008
y.create.l HWIO_PCNOC_EPRB0_SPROF_CFGCTL_ADDR A:0x6050300c
y.create.l HWIO_PCNOC_EPRB0_SPROF_FILTERLUT_ADDR A:0x60503014
y.create.l HWIO_PCNOC_EPRB0_SPROF_TRACEALARMEN_ADDR A:0x60503018
y.create.l HWIO_PCNOC_EPRB0_SPROF_TRACEALARMSTATUS_ADDR A:0x6050301c
y.create.l HWIO_PCNOC_EPRB0_SPROF_TRACEALARMCLR_ADDR A:0x60503020
y.create.l HWIO_PCNOC_EPRB0_SPROF_STATPERIOD_ADDR A:0x60503024
y.create.l HWIO_PCNOC_EPRB0_SPROF_STATGO_ADDR A:0x60503028
y.create.l HWIO_PCNOC_EPRB0_SPROF_STATALARMMIN_ADDR A:0x6050302c
y.create.l HWIO_PCNOC_EPRB0_SPROF_STATALARMMAX_ADDR A:0x60503030
y.create.l HWIO_PCNOC_EPRB0_SPROF_STATALARMSTATUS_ADDR A:0x60503034
y.create.l HWIO_PCNOC_EPRB0_SPROF_STATALARMCLR_ADDR A:0x60503038
y.create.l HWIO_PCNOC_EPRB0_SPROF_FILTERS_0_ROUTEIDBASE_ADDR A:0x60503044
y.create.l HWIO_PCNOC_EPRB0_SPROF_FILTERS_0_ROUTEIDMASK_ADDR A:0x60503048
y.create.l HWIO_PCNOC_EPRB0_SPROF_FILTERS_0_ADDRBASE_LOW_ADDR A:0x6050304c
y.create.l HWIO_PCNOC_EPRB0_SPROF_FILTERS_0_ADDRBASE_HIGH_ADDR A:0x60503050
y.create.l HWIO_PCNOC_EPRB0_SPROF_FILTERS_0_WINDOWSIZE_ADDR A:0x60503054
y.create.l HWIO_PCNOC_EPRB0_SPROF_FILTERS_0_OPCODE_ADDR A:0x60503060
y.create.l HWIO_PCNOC_EPRB0_SPROF_FILTERS_0_STATUS_ADDR A:0x60503064
y.create.l HWIO_PCNOC_EPRB0_SPROF_FILTERS_0_LENGTH_ADDR A:0x60503068
y.create.l HWIO_PCNOC_EPRB0_SPROF_FILTERS_0_URGENCY_ADDR A:0x6050306c
y.create.l HWIO_PCNOC_EPRB0_SPROF_FILTERS_1_ROUTEIDBASE_ADDR A:0x60503080
y.create.l HWIO_PCNOC_EPRB0_SPROF_FILTERS_1_ROUTEIDMASK_ADDR A:0x60503084
y.create.l HWIO_PCNOC_EPRB0_SPROF_FILTERS_1_ADDRBASE_LOW_ADDR A:0x60503088
y.create.l HWIO_PCNOC_EPRB0_SPROF_FILTERS_1_ADDRBASE_HIGH_ADDR A:0x6050308c
y.create.l HWIO_PCNOC_EPRB0_SPROF_FILTERS_1_WINDOWSIZE_ADDR A:0x60503090
y.create.l HWIO_PCNOC_EPRB0_SPROF_FILTERS_1_OPCODE_ADDR A:0x6050309c
y.create.l HWIO_PCNOC_EPRB0_SPROF_FILTERS_1_STATUS_ADDR A:0x605030a0
y.create.l HWIO_PCNOC_EPRB0_SPROF_FILTERS_1_LENGTH_ADDR A:0x605030a4
y.create.l HWIO_PCNOC_EPRB0_SPROF_FILTERS_1_URGENCY_ADDR A:0x605030a8
y.create.l HWIO_PCNOC_EPRB0_SPROF_COUNTERS_0_SRC_ADDR A:0x60503138
y.create.l HWIO_PCNOC_EPRB0_SPROF_COUNTERS_0_ALARMMODE_ADDR A:0x6050313c
y.create.l HWIO_PCNOC_EPRB0_SPROF_COUNTERS_0_VAL_ADDR A:0x60503140
y.create.l HWIO_PCNOC_EPRB0_SPROF_COUNTERS_1_SRC_ADDR A:0x6050314c
y.create.l HWIO_PCNOC_EPRB0_SPROF_COUNTERS_1_ALARMMODE_ADDR A:0x60503150
y.create.l HWIO_PCNOC_EPRB0_SPROF_COUNTERS_1_VAL_ADDR A:0x60503154
y.create.l HWIO_PCNOC_EPRB0_SPROF_COUNTERS_2_SRC_ADDR A:0x60503160
y.create.l HWIO_PCNOC_EPRB0_SPROF_COUNTERS_2_ALARMMODE_ADDR A:0x60503164
y.create.l HWIO_PCNOC_EPRB0_SPROF_COUNTERS_2_VAL_ADDR A:0x60503168
y.create.l HWIO_PCNOC_EPRB0_SPROF_COUNTERS_3_SRC_ADDR A:0x60503174
y.create.l HWIO_PCNOC_EPRB0_SPROF_COUNTERS_3_ALARMMODE_ADDR A:0x60503178
y.create.l HWIO_PCNOC_EPRB0_SPROF_COUNTERS_3_VAL_ADDR A:0x6050317c
y.create.l HWIO_PCNOC_EPRB0_SPROF_COUNTERS_4_SRC_ADDR A:0x60503188
y.create.l HWIO_PCNOC_EPRB0_SPROF_COUNTERS_4_ALARMMODE_ADDR A:0x6050318c
y.create.l HWIO_PCNOC_EPRB0_SPROF_COUNTERS_4_VAL_ADDR A:0x60503190
y.create.l HWIO_PCNOC_EPRB0_SPROF_COUNTERS_5_SRC_ADDR A:0x6050319c
y.create.l HWIO_PCNOC_EPRB0_SPROF_COUNTERS_5_ALARMMODE_ADDR A:0x605031a0
y.create.l HWIO_PCNOC_EPRB0_SPROF_COUNTERS_5_VAL_ADDR A:0x605031a4
y.create.l HWIO_PCNOC_EPRB0_SPROF_COUNTERS_6_SRC_ADDR A:0x605031b0
y.create.l HWIO_PCNOC_EPRB0_SPROF_COUNTERS_6_ALARMMODE_ADDR A:0x605031b4
y.create.l HWIO_PCNOC_EPRB0_SPROF_COUNTERS_6_VAL_ADDR A:0x605031b8
y.create.l HWIO_PCNOC_EPRB0_SPROF_COUNTERS_7_SRC_ADDR A:0x605031c4
y.create.l HWIO_PCNOC_EPRB0_SPROF_COUNTERS_7_ALARMMODE_ADDR A:0x605031c8
y.create.l HWIO_PCNOC_EPRB0_SPROF_COUNTERS_7_VAL_ADDR A:0x605031cc
y.create.l HWIO_PCNOC_TPRB0_SPROF_ID_COREID_ADDR A:0x60504000
y.create.l HWIO_PCNOC_TPRB0_SPROF_ID_REVISIONID_ADDR A:0x60504004
y.create.l HWIO_PCNOC_TPRB0_SPROF_MAINCTL_ADDR A:0x60504008
y.create.l HWIO_PCNOC_TPRB0_SPROF_CFGCTL_ADDR A:0x6050400c
y.create.l HWIO_PCNOC_TPRB0_SPROF_STATPERIOD_ADDR A:0x60504024
y.create.l HWIO_PCNOC_TPRB0_SPROF_STATGO_ADDR A:0x60504028
y.create.l HWIO_PCNOC_TPRB0_SPROF_STATALARMMIN_ADDR A:0x6050402c
y.create.l HWIO_PCNOC_TPRB0_SPROF_STATALARMMAX_ADDR A:0x60504030
y.create.l HWIO_PCNOC_TPRB0_SPROF_STATALARMSTATUS_ADDR A:0x60504034
y.create.l HWIO_PCNOC_TPRB0_SPROF_STATALARMCLR_ADDR A:0x60504038
y.create.l HWIO_PCNOC_TPRB0_SPROF_COUNTERS_0_SRC_ADDR A:0x60504138
y.create.l HWIO_PCNOC_TPRB0_SPROF_COUNTERS_0_ALARMMODE_ADDR A:0x6050413c
y.create.l HWIO_PCNOC_TPRB0_SPROF_COUNTERS_0_VAL_ADDR A:0x60504140
y.create.l HWIO_PCNOC_TPRB0_SPROF_COUNTERS_1_SRC_ADDR A:0x6050414c
y.create.l HWIO_PCNOC_TPRB0_SPROF_COUNTERS_1_ALARMMODE_ADDR A:0x60504150
y.create.l HWIO_PCNOC_TPRB0_SPROF_COUNTERS_1_VAL_ADDR A:0x60504154
y.create.l HWIO_PCNOC_TPRB0_SPROF_COUNTERS_2_SRC_ADDR A:0x60504160
y.create.l HWIO_PCNOC_TPRB0_SPROF_COUNTERS_2_ALARMMODE_ADDR A:0x60504164
y.create.l HWIO_PCNOC_TPRB0_SPROF_COUNTERS_2_VAL_ADDR A:0x60504168
y.create.l HWIO_PCNOC_TPRB0_SPROF_COUNTERS_3_SRC_ADDR A:0x60504174
y.create.l HWIO_PCNOC_TPRB0_SPROF_COUNTERS_3_ALARMMODE_ADDR A:0x60504178
y.create.l HWIO_PCNOC_TPRB0_SPROF_COUNTERS_3_VAL_ADDR A:0x6050417c
y.create.l HWIO_PCNOC_TPRB0_SPROF_COUNTERS_4_SRC_ADDR A:0x60504188
y.create.l HWIO_PCNOC_TPRB0_SPROF_COUNTERS_4_ALARMMODE_ADDR A:0x6050418c
y.create.l HWIO_PCNOC_TPRB0_SPROF_COUNTERS_4_VAL_ADDR A:0x60504190
y.create.l HWIO_PCNOC_TPRB0_SPROF_COUNTERS_5_SRC_ADDR A:0x6050419c
y.create.l HWIO_PCNOC_TPRB0_SPROF_COUNTERS_5_ALARMMODE_ADDR A:0x605041a0
y.create.l HWIO_PCNOC_TPRB0_SPROF_COUNTERS_5_VAL_ADDR A:0x605041a4
y.create.l HWIO_PCNOC_TPRB0_SPROF_COUNTERS_6_SRC_ADDR A:0x605041b0
y.create.l HWIO_PCNOC_TPRB0_SPROF_COUNTERS_6_ALARMMODE_ADDR A:0x605041b4
y.create.l HWIO_PCNOC_TPRB0_SPROF_COUNTERS_6_VAL_ADDR A:0x605041b8
y.create.l HWIO_PCNOC_TPRB0_SPROF_COUNTERS_7_SRC_ADDR A:0x605041c4
y.create.l HWIO_PCNOC_TPRB0_SPROF_COUNTERS_7_ALARMMODE_ADDR A:0x605041c8
y.create.l HWIO_PCNOC_TPRB0_SPROF_COUNTERS_7_VAL_ADDR A:0x605041cc
y.create.l HWIO_PCNOC_TPRB0_SPROF_COUNTERS_8_SRC_ADDR A:0x605041d8
y.create.l HWIO_PCNOC_TPRB0_SPROF_COUNTERS_8_ALARMMODE_ADDR A:0x605041dc
y.create.l HWIO_PCNOC_TPRB0_SPROF_COUNTERS_8_VAL_ADDR A:0x605041e0
y.create.l HWIO_PCNOC_TPRB0_SPROF_COUNTERS_9_SRC_ADDR A:0x605041ec
y.create.l HWIO_PCNOC_TPRB0_SPROF_COUNTERS_9_ALARMMODE_ADDR A:0x605041f0
y.create.l HWIO_PCNOC_TPRB0_SPROF_COUNTERS_9_VAL_ADDR A:0x605041f4
y.create.l HWIO_PCNOC_TPRB0_SPROF_COUNTERS_10_SRC_ADDR A:0x60504200
y.create.l HWIO_PCNOC_TPRB0_SPROF_COUNTERS_10_ALARMMODE_ADDR A:0x60504204
y.create.l HWIO_PCNOC_TPRB0_SPROF_COUNTERS_10_VAL_ADDR A:0x60504208
y.create.l HWIO_PCNOC_TPRB0_SPROF_COUNTERS_11_SRC_ADDR A:0x60504214
y.create.l HWIO_PCNOC_TPRB0_SPROF_COUNTERS_11_ALARMMODE_ADDR A:0x60504218
y.create.l HWIO_PCNOC_TPRB0_SPROF_COUNTERS_11_VAL_ADDR A:0x6050421c
y.create.l HWIO_PCNOC_TPRB0_SPROF_COUNTERS_12_SRC_ADDR A:0x60504228
y.create.l HWIO_PCNOC_TPRB0_SPROF_COUNTERS_12_ALARMMODE_ADDR A:0x6050422c
y.create.l HWIO_PCNOC_TPRB0_SPROF_COUNTERS_12_VAL_ADDR A:0x60504230
y.create.l HWIO_PCNOC_TPRB0_SPROF_COUNTERS_13_SRC_ADDR A:0x6050423c
y.create.l HWIO_PCNOC_TPRB0_SPROF_COUNTERS_13_ALARMMODE_ADDR A:0x60504240
y.create.l HWIO_PCNOC_TPRB0_SPROF_COUNTERS_13_VAL_ADDR A:0x60504244
y.create.l HWIO_PCNOC_TPRB0_SPROF_COUNTERS_14_SRC_ADDR A:0x60504250
y.create.l HWIO_PCNOC_TPRB0_SPROF_COUNTERS_14_ALARMMODE_ADDR A:0x60504254
y.create.l HWIO_PCNOC_TPRB0_SPROF_COUNTERS_14_VAL_ADDR A:0x60504258
y.create.l HWIO_PCNOC_TPRB0_SPROF_COUNTERS_15_SRC_ADDR A:0x60504264
y.create.l HWIO_PCNOC_TPRB0_SPROF_COUNTERS_15_ALARMMODE_ADDR A:0x60504268
y.create.l HWIO_PCNOC_TPRB0_SPROF_COUNTERS_15_VAL_ADDR A:0x6050426c
y.create.l HWIO_PCNOC_CRYPTO0_QOS_ID_COREID_ADDR A:0x60507000
y.create.l HWIO_PCNOC_CRYPTO0_QOS_ID_REVISIONID_ADDR A:0x60507004
y.create.l HWIO_PCNOC_CRYPTO0_QOS_PRIORITY_ADDR A:0x60507008
y.create.l HWIO_PCNOC_CRYPTO0_QOS_MODE_ADDR A:0x6050700c
y.create.l HWIO_PCNOC_CRYPTO0_QOS_EXTCONTROL_ADDR A:0x60507018
y.create.l HWIO_PCNOC_QHM1_QOS_ID_COREID_ADDR A:0x6050c000
y.create.l HWIO_PCNOC_QHM1_QOS_ID_REVISIONID_ADDR A:0x6050c004
y.create.l HWIO_PCNOC_QHM1_QOS_PRIORITY_ADDR A:0x6050c008
y.create.l HWIO_PCNOC_QHM1_QOS_MODE_ADDR A:0x6050c00c
y.create.l HWIO_PCNOC_QHM1_QOS_EXTCONTROL_ADDR A:0x6050c018
y.create.l HWIO_PCNOC_QHM2_QOS_ID_COREID_ADDR A:0x6050d000
y.create.l HWIO_PCNOC_QHM2_QOS_ID_REVISIONID_ADDR A:0x6050d004
y.create.l HWIO_PCNOC_QHM2_QOS_PRIORITY_ADDR A:0x6050d008
y.create.l HWIO_PCNOC_QHM2_QOS_MODE_ADDR A:0x6050d00c
y.create.l HWIO_PCNOC_QHM2_QOS_EXTCONTROL_ADDR A:0x6050d018
y.create.l HWIO_PCNOC_SNOC_QOS_ID_COREID_ADDR A:0x60510000
y.create.l HWIO_PCNOC_SNOC_QOS_ID_REVISIONID_ADDR A:0x60510004
y.create.l HWIO_PCNOC_SNOC_QOS_PRIORITY_ADDR A:0x60510008
y.create.l HWIO_PCNOC_SNOC_QOS_MODE_ADDR A:0x6051000c
y.create.l HWIO_PCNOC_SNOC_QOS_EXTCONTROL_ADDR A:0x60510018
y.create.l HWIO_PDM_TCXO_PDM0_TOP_CTL_ADDR A:0x60068000
y.create.l HWIO_PDM_PDM0_CTL_ADDR A:0x60068004
y.create.l HWIO_PDM_WEB_TCXO4_TEST_ADDR A:0x60068008
y.create.l HWIO_PDM_TCXO_PDM1_TOP_CTL_ADDR A:0x60069000
y.create.l HWIO_PDM_PDM1_CTL_ADDR A:0x60069004
y.create.l HWIO_PDM_TCXO_PDM2_TOP_CTL_ADDR A:0x6006a000
y.create.l HWIO_PDM_PDM2_CTL_ADDR A:0x6006a004
y.create.l HWIO_PDM_GP_MN_CLK_MDIV_ADDR A:0x6006b000
y.create.l HWIO_PDM_GP_MN_CLK_NDIV_ADDR A:0x6006b004
y.create.l HWIO_PDM_GP_MN_CLK_DUTY_ADDR A:0x6006b008
y.create.l HWIO_SPMI_GENI_CLK_CTRL_ADDR A:0x6200a000
y.create.l HWIO_SPMI_GENI_HW_VERSION_ADDR A:0x6200a004
y.create.l HWIO_SPMI_GENI_FW_REVISION_ADDR A:0x6200a008
y.create.l HWIO_SPMI_GENI_S_FW_REVISION_ADDR A:0x6200a00c
y.create.l HWIO_SPMI_GENI_FORCE_DEFAULT_REG_ADDR A:0x6200a010
y.create.l HWIO_SPMI_GENI_OUTPUT_CTRL_ADDR A:0x6200a014
y.create.l HWIO_SPMI_GENI_CGC_CTRL_ADDR A:0x6200a018
y.create.l HWIO_SPMI_GENI_CHAR_CFG_ADDR A:0x6200a01c
y.create.l HWIO_SPMI_GENI_CHAR_DATA_0_ADDR A:0x6200a020
y.create.l HWIO_SPMI_GENI_CHAR_DATA_1_ADDR A:0x6200a024
y.create.l HWIO_SPMI_GENI_CTRL_ADDR A:0x6200a028
y.create.l HWIO_SPMI_GENI_STATUS_ADDR A:0x6200a02c
y.create.l HWIO_SPMI_GENI_TEST_BUS_CTRL_ADDR A:0x6200a030
y.create.l HWIO_SPMI_GENI_SER_CLK_CFG_ADDR A:0x6200a034
y.create.l HWIO_SPMI_GENI_TX_WATERMARK_REG_ADDR A:0x6200a038
y.create.l HWIO_SPMI_GENI_RX_WATERMARK_REG_ADDR A:0x6200a03c
y.create.l HWIO_SPMI_GENI_STOP_REG_ADDR A:0x6200a040
y.create.l HWIO_SPMI_GENI_SW_COMP_REG_ADDR A:0x6200a044
y.create.l HWIO_SPMI_GENI_PROG_ROM_CTRL_REG_ADDR A:0x6200a048
y.create.l HWIO_SPMI_GENI_CFG_REG0_ADDR A:0x6200a100
y.create.l HWIO_SPMI_GENI_CFG_REG1_ADDR A:0x6200a104
y.create.l HWIO_SPMI_GENI_CFG_REG2_ADDR A:0x6200a108
y.create.l HWIO_SPMI_GENI_CFG_REG3_ADDR A:0x6200a10c
y.create.l HWIO_SPMI_GENI_CFG_REG4_ADDR A:0x6200a110
y.create.l HWIO_SPMI_GENI_CFG_REG5_ADDR A:0x6200a114
y.create.l HWIO_SPMI_GENI_CFG_REG6_ADDR A:0x6200a118
y.create.l HWIO_SPMI_GENI_CFG_REG7_ADDR A:0x6200a11c
y.create.l HWIO_SPMI_GENI_CFG_REG8_ADDR A:0x6200a120
y.create.l HWIO_SPMI_GENI_CFG_REG9_ADDR A:0x6200a124
y.create.l HWIO_SPMI_GENI_CFG_REG10_ADDR A:0x6200a128
y.create.l HWIO_SPMI_GENI_CFG_REG11_ADDR A:0x6200a12c
y.create.l HWIO_SPMI_GENI_CFG_REG12_ADDR A:0x6200a130
y.create.l HWIO_SPMI_GENI_CFG_REG13_ADDR A:0x6200a134
y.create.l HWIO_SPMI_GENI_CFG_REG14_ADDR A:0x6200a138
y.create.l HWIO_SPMI_GENI_CFG_REG15_ADDR A:0x6200a13c
y.create.l HWIO_SPMI_GENI_CFG_REG16_ADDR A:0x6200a140
y.create.l HWIO_SPMI_GENI_CFG_REG17_ADDR A:0x6200a144
y.create.l HWIO_SPMI_GENI_CFG_REG18_ADDR A:0x6200a148
y.create.l HWIO_SPMI_GENI_CFG_REG19_ADDR A:0x6200a14c
y.create.l HWIO_SPMI_GENI_CFG_REG20_ADDR A:0x6200a150
y.create.l HWIO_SPMI_GENI_CFG_REG21_ADDR A:0x6200a154
y.create.l HWIO_SPMI_GENI_CFG_REG22_ADDR A:0x6200a158
y.create.l HWIO_SPMI_GENI_CFG_REG23_ADDR A:0x6200a15c
y.create.l HWIO_SPMI_GENI_CFG_REG24_ADDR A:0x6200a160
y.create.l HWIO_SPMI_GENI_CFG_REG25_ADDR A:0x6200a164
y.create.l HWIO_SPMI_GENI_CFG_REG26_ADDR A:0x6200a168
y.create.l HWIO_SPMI_GENI_CFG_REG27_ADDR A:0x6200a16c
y.create.l HWIO_SPMI_GENI_CFG_REG28_ADDR A:0x6200a170
y.create.l HWIO_SPMI_GENI_CFG_REG29_ADDR A:0x6200a174
y.create.l HWIO_SPMI_GENI_CFG_REG30_ADDR A:0x6200a178
y.create.l HWIO_SPMI_GENI_CFG_RAM0_ADDR A:0x6200a200
y.create.l HWIO_SPMI_GENI_CFG_RAM1_ADDR A:0x6200a204
y.create.l HWIO_SPMI_GENI_CFG_RAM2_ADDR A:0x6200a208
y.create.l HWIO_SPMI_GENI_CFG_RAM3_ADDR A:0x6200a20c
y.create.l HWIO_SPMI_GENI_CFG_RAM4_ADDR A:0x6200a210
y.create.l HWIO_SPMI_GENI_CFG_RAM5_ADDR A:0x6200a214
y.create.l HWIO_SPMI_GENI_CFG_RAM6_ADDR A:0x6200a218
y.create.l HWIO_SPMI_GENI_CFG_RAM7_ADDR A:0x6200a21c
y.create.l HWIO_SPMI_GENI_CFG_RAM8_ADDR A:0x6200a220
y.create.l HWIO_SPMI_GENI_CFG_RAM9_ADDR A:0x6200a224
y.create.l HWIO_SPMI_PERIPH0_2OWNER_TABLE_REG_ADDR A:0x6200a700
y.create.l HWIO_SPMI_PERIPH1_2OWNER_TABLE_REG_ADDR A:0x6200a704
y.create.l HWIO_SPMI_PERIPH2_2OWNER_TABLE_REG_ADDR A:0x6200a708
y.create.l HWIO_SPMI_PERIPH3_2OWNER_TABLE_REG_ADDR A:0x6200a70c
y.create.l HWIO_SPMI_PERIPH4_2OWNER_TABLE_REG_ADDR A:0x6200a710
y.create.l HWIO_SPMI_PERIPH5_2OWNER_TABLE_REG_ADDR A:0x6200a714
y.create.l HWIO_SPMI_PERIPH6_2OWNER_TABLE_REG_ADDR A:0x6200a718
y.create.l HWIO_SPMI_PERIPH7_2OWNER_TABLE_REG_ADDR A:0x6200a71c
y.create.l HWIO_SPMI_PERIPH8_2OWNER_TABLE_REG_ADDR A:0x6200a720
y.create.l HWIO_SPMI_PERIPH9_2OWNER_TABLE_REG_ADDR A:0x6200a724
y.create.l HWIO_SPMI_MAPPING_TABLE_REG0_ADDR A:0x6200ab00
y.create.l HWIO_SPMI_MAPPING_TABLE_REG1_ADDR A:0x6200ab04
y.create.l HWIO_SPMI_MAPPING_TABLE_REG2_ADDR A:0x6200ab08
y.create.l HWIO_SPMI_MAPPING_TABLE_REG3_ADDR A:0x6200ab0c
y.create.l HWIO_SPMI_MAPPING_TABLE_REG4_ADDR A:0x6200ab10
y.create.l HWIO_SPMI_MAPPING_TABLE_REG5_ADDR A:0x6200ab14
y.create.l HWIO_SPMI_MAPPING_TABLE_REG6_ADDR A:0x6200ab18
y.create.l HWIO_SPMI_MAPPING_TABLE_REG7_ADDR A:0x6200ab1c
y.create.l HWIO_SPMI_MAPPING_TABLE_REG8_ADDR A:0x6200ab20
y.create.l HWIO_SPMI_MAPPING_TABLE_REG9_ADDR A:0x6200ab24
y.create.l HWIO_SPMI_MID_REG_ADDR A:0x6200af00
y.create.l HWIO_SPMI_CFG_REG_ADDR A:0x6200af04
y.create.l HWIO_SPMI_SEC_DISABLE_REG_ADDR A:0x6200af08
y.create.l HWIO_SPMI_HW_VERSION_ADDR A:0x6200af0c
y.create.l HWIO_SPMI_CGC_CTRL_ADDR A:0x6200af10
y.create.l HWIO_SPMI_MWB_ENABLE_REG_ADDR A:0x6200af14
y.create.l HWIO_SPMI_CHAR_CFG_ADDR A:0x6200af40
y.create.l HWIO_SPMI_CHAR_DATA_0_ADDR A:0x6200af44
y.create.l HWIO_SPMI_CHAR_DATA_1_ADDR A:0x6200af48
y.create.l HWIO_SPMI_CMPR_EN_REG_ADDR A:0x6200af54
y.create.l HWIO_SPMI_PROTOCOL_IRQ_STATUS_ADDR A:0x6200b000
y.create.l HWIO_SPMI_PROTOCOL_IRQ_ENABLE_ADDR A:0x6200b004
y.create.l HWIO_SPMI_PROTOCOL_IRQ_CLEAR_ADDR A:0x6200b008
y.create.l HWIO_SPMI_PROTOCOL_IRQ_EN_SET_ADDR A:0x6200b00c
y.create.l HWIO_SPMI_PROTOCOL_IRQ_EN_CLEAR_ADDR A:0x6200b010
y.create.l HWIO_SPMI_TEST_BUS_CTRL_ADDR A:0x6200c000
y.create.l HWIO_SPMI_HW_SW_EVENTS_CTRL_ADDR A:0x6200c004
y.create.l HWIO_SPMI_HW_SW_EVENTS_BITWISE_REG0_ADDR A:0x6200c008
y.create.l HWIO_SPMI_HW_SW_EVENTS_BITWISE_REG1_ADDR A:0x6200c00c
y.create.l HWIO_SPMI_HW_SW_EVENTS_BITWISE_REG2_ADDR A:0x6200c010
y.create.l HWIO_SPMI_HW_SW_EVENTS_BITWISE_REG3_ADDR A:0x6200c014
y.create.l HWIO_SPMI_HW_SW_EVENTS_BITWISE_REG4_ADDR A:0x6200c018
y.create.l HWIO_SPMI_HW_SW_EVENTS_BITWISE_REG5_ADDR A:0x6200c01c
y.create.l HWIO_SPMI_HW_SW_EVENTS_BITWISE_REG6_ADDR A:0x6200c020
y.create.l HWIO_SPMI_HW_SW_EVENTS_BITWISE_REG7_ADDR A:0x6200c024
y.create.l HWIO_SPMI_PIC_OWNER0_ACC_STATUS0_ADDR A:0x63900000
y.create.l HWIO_SPMI_PIC_OWNER0_ACC_STATUS1_ADDR A:0x63900004
y.create.l HWIO_SPMI_PIC_OWNER0_ACC_STATUS2_ADDR A:0x63900008
y.create.l HWIO_SPMI_PIC_OWNER0_ACC_STATUS3_ADDR A:0x6390000c
y.create.l HWIO_SPMI_PIC_OWNER1_ACC_STATUS0_ADDR A:0x63901000
y.create.l HWIO_SPMI_PIC_OWNER1_ACC_STATUS1_ADDR A:0x63901004
y.create.l HWIO_SPMI_PIC_OWNER1_ACC_STATUS2_ADDR A:0x63901008
y.create.l HWIO_SPMI_PIC_OWNER1_ACC_STATUS3_ADDR A:0x6390100c
y.create.l HWIO_SPMI_PIC_OWNER2_ACC_STATUS0_ADDR A:0x63902000
y.create.l HWIO_SPMI_PIC_OWNER2_ACC_STATUS1_ADDR A:0x63902004
y.create.l HWIO_SPMI_PIC_OWNER2_ACC_STATUS2_ADDR A:0x63902008
y.create.l HWIO_SPMI_PIC_OWNER2_ACC_STATUS3_ADDR A:0x6390200c
y.create.l HWIO_SPMI_PIC_OWNER3_ACC_STATUS0_ADDR A:0x63903000
y.create.l HWIO_SPMI_PIC_OWNER3_ACC_STATUS1_ADDR A:0x63903004
y.create.l HWIO_SPMI_PIC_OWNER3_ACC_STATUS2_ADDR A:0x63903008
y.create.l HWIO_SPMI_PIC_OWNER3_ACC_STATUS3_ADDR A:0x6390300c
y.create.l HWIO_SPMI_PIC_OWNER4_ACC_STATUS0_ADDR A:0x63904000
y.create.l HWIO_SPMI_PIC_OWNER4_ACC_STATUS1_ADDR A:0x63904004
y.create.l HWIO_SPMI_PIC_OWNER4_ACC_STATUS2_ADDR A:0x63904008
y.create.l HWIO_SPMI_PIC_OWNER4_ACC_STATUS3_ADDR A:0x6390400c
y.create.l HWIO_SPMI_PIC_OWNER5_ACC_STATUS0_ADDR A:0x63905000
y.create.l HWIO_SPMI_PIC_OWNER5_ACC_STATUS1_ADDR A:0x63905004
y.create.l HWIO_SPMI_PIC_OWNER5_ACC_STATUS2_ADDR A:0x63905008
y.create.l HWIO_SPMI_PIC_OWNER5_ACC_STATUS3_ADDR A:0x6390500c
y.create.l HWIO_SPMI_PIC_ACC_ENABLE0_ADDR A:0x63800000
y.create.l HWIO_SPMI_PIC_ACC_ENABLE1_ADDR A:0x63801000
y.create.l HWIO_SPMI_PIC_ACC_ENABLE2_ADDR A:0x63802000
y.create.l HWIO_SPMI_PIC_ACC_ENABLE3_ADDR A:0x63803000
y.create.l HWIO_SPMI_PIC_ACC_ENABLE4_ADDR A:0x63804000
y.create.l HWIO_SPMI_PIC_ACC_ENABLE5_ADDR A:0x63805000
y.create.l HWIO_SPMI_PIC_ACC_ENABLE6_ADDR A:0x63806000
y.create.l HWIO_SPMI_PIC_ACC_ENABLE7_ADDR A:0x63807000
y.create.l HWIO_SPMI_PIC_ACC_ENABLE8_ADDR A:0x63808000
y.create.l HWIO_SPMI_PIC_ACC_ENABLE9_ADDR A:0x63809000
y.create.l HWIO_SPMI_PIC_IRQ_STATUS0_ADDR A:0x63800004
y.create.l HWIO_SPMI_PIC_IRQ_STATUS1_ADDR A:0x63801004
y.create.l HWIO_SPMI_PIC_IRQ_STATUS2_ADDR A:0x63802004
y.create.l HWIO_SPMI_PIC_IRQ_STATUS3_ADDR A:0x63803004
y.create.l HWIO_SPMI_PIC_IRQ_STATUS4_ADDR A:0x63804004
y.create.l HWIO_SPMI_PIC_IRQ_STATUS5_ADDR A:0x63805004
y.create.l HWIO_SPMI_PIC_IRQ_STATUS6_ADDR A:0x63806004
y.create.l HWIO_SPMI_PIC_IRQ_STATUS7_ADDR A:0x63807004
y.create.l HWIO_SPMI_PIC_IRQ_STATUS8_ADDR A:0x63808004
y.create.l HWIO_SPMI_PIC_IRQ_STATUS9_ADDR A:0x63809004
y.create.l HWIO_SPMI_PIC_IRQ_CLEAR0_ADDR A:0x63800008
y.create.l HWIO_SPMI_PIC_IRQ_CLEAR1_ADDR A:0x63801008
y.create.l HWIO_SPMI_PIC_IRQ_CLEAR2_ADDR A:0x63802008
y.create.l HWIO_SPMI_PIC_IRQ_CLEAR3_ADDR A:0x63803008
y.create.l HWIO_SPMI_PIC_IRQ_CLEAR4_ADDR A:0x63804008
y.create.l HWIO_SPMI_PIC_IRQ_CLEAR5_ADDR A:0x63805008
y.create.l HWIO_SPMI_PIC_IRQ_CLEAR6_ADDR A:0x63806008
y.create.l HWIO_SPMI_PIC_IRQ_CLEAR7_ADDR A:0x63807008
y.create.l HWIO_SPMI_PIC_IRQ_CLEAR8_ADDR A:0x63808008
y.create.l HWIO_SPMI_PIC_IRQ_CLEAR9_ADDR A:0x63809008
y.create.l HWIO_PMIC_ARB_XPU_SCR_ADDR A:0x6200e000
y.create.l HWIO_PMIC_ARB_XPU_SWDR_ADDR A:0x6200e004
y.create.l HWIO_PMIC_ARB_XPU_PRTN_RACR_SSHADOW_ADDR A:0x6200e008
y.create.l HWIO_PMIC_ARB_XPU_PRTN_WACR_SSHADOW_ADDR A:0x6200e00c
y.create.l HWIO_PMIC_ARB_XPU_PRTN_START_SSHADOW0_ADDR A:0x6200e010
y.create.l HWIO_PMIC_ARB_XPU_PRTN_END_SSHADOW0_ADDR A:0x6200e018
y.create.l HWIO_PMIC_ARB_XPU_SEAR0_ADDR A:0x6200e040
y.create.l HWIO_PMIC_ARB_XPU_SESR_ADDR A:0x6200e048
y.create.l HWIO_PMIC_ARB_XPU_SESRRESTORE_ADDR A:0x6200e04c
y.create.l HWIO_PMIC_ARB_XPU_SESYNR0_ADDR A:0x6200e050
y.create.l HWIO_PMIC_ARB_XPU_SESYNR1_ADDR A:0x6200e054
y.create.l HWIO_PMIC_ARB_XPU_SESYNR2_ADDR A:0x6200e058
y.create.l HWIO_PMIC_ARB_XPU_MCR_ADDR A:0x6200e100
y.create.l HWIO_PMIC_ARB_XPU_MEAR0_ADDR A:0x6200e140
y.create.l HWIO_PMIC_ARB_XPU_MESR_ADDR A:0x6200e148
y.create.l HWIO_PMIC_ARB_XPU_MESRRESTORE_ADDR A:0x6200e14c
y.create.l HWIO_PMIC_ARB_XPU_MESYNR0_ADDR A:0x6200e150
y.create.l HWIO_PMIC_ARB_XPU_MESYNR1_ADDR A:0x6200e154
y.create.l HWIO_PMIC_ARB_XPU_MESYNR2_ADDR A:0x6200e158
y.create.l HWIO_PMIC_ARB_XPU_CR_ADDR A:0x6200e080
y.create.l HWIO_PMIC_ARB_XPU_PRTN_RACR_SHADOW_ADDR A:0x6200e088
y.create.l HWIO_PMIC_ARB_XPU_PRTN_WACR_SHADOW_ADDR A:0x6200e08c
y.create.l HWIO_PMIC_ARB_XPU_PRTN_START_SHADOW0_ADDR A:0x6200e090
y.create.l HWIO_PMIC_ARB_XPU_PRTN_END_SHADOW0_ADDR A:0x6200e098
y.create.l HWIO_PMIC_ARB_XPU_RPU_ACR0_ADDR A:0x6200e0a0
y.create.l HWIO_PMIC_ARB_XPU_EAR0_ADDR A:0x6200e0c0
y.create.l HWIO_PMIC_ARB_XPU_ESR_ADDR A:0x6200e0c8
y.create.l HWIO_PMIC_ARB_XPU_ESRRESTORE_ADDR A:0x6200e0cc
y.create.l HWIO_PMIC_ARB_XPU_ESYNR0_ADDR A:0x6200e0d0
y.create.l HWIO_PMIC_ARB_XPU_ESYNR1_ADDR A:0x6200e0d4
y.create.l HWIO_PMIC_ARB_XPU_ESYNR2_ADDR A:0x6200e0d8
y.create.l HWIO_PMIC_ARB_XPU_UMR_RACR_ADDR A:0x6200e0e0
y.create.l HWIO_PMIC_ARB_XPU_UMR_WACR_ADDR A:0x6200e0e4
y.create.l HWIO_PMIC_ARB_XPU_UMR_CNTL_ADDR A:0x6200e0f0
y.create.l HWIO_PMIC_ARB_XPU_IDR0_ADDR A:0x6200e074
y.create.l HWIO_PMIC_ARB_XPU_IDR1_ADDR A:0x6200e078
y.create.l HWIO_PMIC_ARB_XPU_REV_ADDR A:0x6200e07c
y.create.l HWIO_PMIC_ARB_XPU_PRT0_RACR0_ADDR A:0x6200e200
y.create.l HWIO_PMIC_ARB_XPU_PRT1_RACR0_ADDR A:0x6200e280
y.create.l HWIO_PMIC_ARB_XPU_PRT2_RACR0_ADDR A:0x6200e300
y.create.l HWIO_PMIC_ARB_XPU_PRT3_RACR0_ADDR A:0x6200e380
y.create.l HWIO_PMIC_ARB_XPU_PRT4_RACR0_ADDR A:0x6200e400
y.create.l HWIO_PMIC_ARB_XPU_PRT5_RACR0_ADDR A:0x6200e480
y.create.l HWIO_PMIC_ARB_XPU_PRT6_RACR0_ADDR A:0x6200e500
y.create.l HWIO_PMIC_ARB_XPU_PRT7_RACR0_ADDR A:0x6200e580
y.create.l HWIO_PMIC_ARB_XPU_PRT8_RACR0_ADDR A:0x6200e600
y.create.l HWIO_PMIC_ARB_XPU_PRT9_RACR0_ADDR A:0x6200e680
y.create.l HWIO_PMIC_ARB_XPU_PRT0_WACR0_ADDR A:0x6200e220
y.create.l HWIO_PMIC_ARB_XPU_PRT1_WACR0_ADDR A:0x6200e2a0
y.create.l HWIO_PMIC_ARB_XPU_PRT2_WACR0_ADDR A:0x6200e320
y.create.l HWIO_PMIC_ARB_XPU_PRT3_WACR0_ADDR A:0x6200e3a0
y.create.l HWIO_PMIC_ARB_XPU_PRT4_WACR0_ADDR A:0x6200e420
y.create.l HWIO_PMIC_ARB_XPU_PRT5_WACR0_ADDR A:0x6200e4a0
y.create.l HWIO_PMIC_ARB_XPU_PRT6_WACR0_ADDR A:0x6200e520
y.create.l HWIO_PMIC_ARB_XPU_PRT7_WACR0_ADDR A:0x6200e5a0
y.create.l HWIO_PMIC_ARB_XPU_PRT8_WACR0_ADDR A:0x6200e620
y.create.l HWIO_PMIC_ARB_XPU_PRT9_WACR0_ADDR A:0x6200e6a0
y.create.l HWIO_PMIC_ARB_XPU_PRT0_START0_ADDR A:0x6200e240
y.create.l HWIO_PMIC_ARB_XPU_PRT1_START0_ADDR A:0x6200e2c0
y.create.l HWIO_PMIC_ARB_XPU_PRT2_START0_ADDR A:0x6200e340
y.create.l HWIO_PMIC_ARB_XPU_PRT3_START0_ADDR A:0x6200e3c0
y.create.l HWIO_PMIC_ARB_XPU_PRT4_START0_ADDR A:0x6200e440
y.create.l HWIO_PMIC_ARB_XPU_PRT5_START0_ADDR A:0x6200e4c0
y.create.l HWIO_PMIC_ARB_XPU_PRT6_START0_ADDR A:0x6200e540
y.create.l HWIO_PMIC_ARB_XPU_PRT7_START0_ADDR A:0x6200e5c0
y.create.l HWIO_PMIC_ARB_XPU_PRT8_START0_ADDR A:0x6200e640
y.create.l HWIO_PMIC_ARB_XPU_PRT9_START0_ADDR A:0x6200e6c0
y.create.l HWIO_PMIC_ARB_XPU_PRT0_END0_ADDR A:0x6200e248
y.create.l HWIO_PMIC_ARB_XPU_PRT1_END0_ADDR A:0x6200e2c8
y.create.l HWIO_PMIC_ARB_XPU_PRT2_END0_ADDR A:0x6200e348
y.create.l HWIO_PMIC_ARB_XPU_PRT3_END0_ADDR A:0x6200e3c8
y.create.l HWIO_PMIC_ARB_XPU_PRT4_END0_ADDR A:0x6200e448
y.create.l HWIO_PMIC_ARB_XPU_PRT5_END0_ADDR A:0x6200e4c8
y.create.l HWIO_PMIC_ARB_XPU_PRT6_END0_ADDR A:0x6200e548
y.create.l HWIO_PMIC_ARB_XPU_PRT7_END0_ADDR A:0x6200e5c8
y.create.l HWIO_PMIC_ARB_XPU_PRT8_END0_ADDR A:0x6200e648
y.create.l HWIO_PMIC_ARB_XPU_PRT9_END0_ADDR A:0x6200e6c8
y.create.l HWIO_PMIC_ARB_XPU_PRT0_SCR_ADDR A:0x6200e250
y.create.l HWIO_PMIC_ARB_XPU_PRT1_SCR_ADDR A:0x6200e2d0
y.create.l HWIO_PMIC_ARB_XPU_PRT2_SCR_ADDR A:0x6200e350
y.create.l HWIO_PMIC_ARB_XPU_PRT3_SCR_ADDR A:0x6200e3d0
y.create.l HWIO_PMIC_ARB_XPU_PRT4_SCR_ADDR A:0x6200e450
y.create.l HWIO_PMIC_ARB_XPU_PRT5_SCR_ADDR A:0x6200e4d0
y.create.l HWIO_PMIC_ARB_XPU_PRT6_SCR_ADDR A:0x6200e550
y.create.l HWIO_PMIC_ARB_XPU_PRT7_SCR_ADDR A:0x6200e5d0
y.create.l HWIO_PMIC_ARB_XPU_PRT8_SCR_ADDR A:0x6200e650
y.create.l HWIO_PMIC_ARB_XPU_PRT9_SCR_ADDR A:0x6200e6d0
y.create.l HWIO_PMIC_ARB_XPU_PRT0_MCR_ADDR A:0x6200e254
y.create.l HWIO_PMIC_ARB_XPU_PRT1_MCR_ADDR A:0x6200e2d4
y.create.l HWIO_PMIC_ARB_XPU_PRT2_MCR_ADDR A:0x6200e354
y.create.l HWIO_PMIC_ARB_XPU_PRT3_MCR_ADDR A:0x6200e3d4
y.create.l HWIO_PMIC_ARB_XPU_PRT4_MCR_ADDR A:0x6200e454
y.create.l HWIO_PMIC_ARB_XPU_PRT5_MCR_ADDR A:0x6200e4d4
y.create.l HWIO_PMIC_ARB_XPU_PRT6_MCR_ADDR A:0x6200e554
y.create.l HWIO_PMIC_ARB_XPU_PRT7_MCR_ADDR A:0x6200e5d4
y.create.l HWIO_PMIC_ARB_XPU_PRT8_MCR_ADDR A:0x6200e654
y.create.l HWIO_PMIC_ARB_XPU_PRT9_MCR_ADDR A:0x6200e6d4
y.create.l HWIO_PMIC_ARB_XPU_PRT0_CNTL0_ADDR A:0x6200e258
y.create.l HWIO_PMIC_ARB_XPU_PRT1_CNTL0_ADDR A:0x6200e2d8
y.create.l HWIO_PMIC_ARB_XPU_PRT2_CNTL0_ADDR A:0x6200e358
y.create.l HWIO_PMIC_ARB_XPU_PRT3_CNTL0_ADDR A:0x6200e3d8
y.create.l HWIO_PMIC_ARB_XPU_PRT4_CNTL0_ADDR A:0x6200e458
y.create.l HWIO_PMIC_ARB_XPU_PRT5_CNTL0_ADDR A:0x6200e4d8
y.create.l HWIO_PMIC_ARB_XPU_PRT6_CNTL0_ADDR A:0x6200e558
y.create.l HWIO_PMIC_ARB_XPU_PRT7_CNTL0_ADDR A:0x6200e5d8
y.create.l HWIO_PMIC_ARB_XPU_PRT8_CNTL0_ADDR A:0x6200e658
y.create.l HWIO_PMIC_ARB_XPU_PRT9_CNTL0_ADDR A:0x6200e6d8
y.create.l HWIO_PMIC_ARB_XPU_PRT0_CNTL1_ADDR A:0x6200e25c
y.create.l HWIO_PMIC_ARB_XPU_PRT1_CNTL1_ADDR A:0x6200e2dc
y.create.l HWIO_PMIC_ARB_XPU_PRT2_CNTL1_ADDR A:0x6200e35c
y.create.l HWIO_PMIC_ARB_XPU_PRT3_CNTL1_ADDR A:0x6200e3dc
y.create.l HWIO_PMIC_ARB_XPU_PRT4_CNTL1_ADDR A:0x6200e45c
y.create.l HWIO_PMIC_ARB_XPU_PRT5_CNTL1_ADDR A:0x6200e4dc
y.create.l HWIO_PMIC_ARB_XPU_PRT6_CNTL1_ADDR A:0x6200e55c
y.create.l HWIO_PMIC_ARB_XPU_PRT7_CNTL1_ADDR A:0x6200e5dc
y.create.l HWIO_PMIC_ARB_XPU_PRT8_CNTL1_ADDR A:0x6200e65c
y.create.l HWIO_PMIC_ARB_XPU_PRT9_CNTL1_ADDR A:0x6200e6dc
y.create.l HWIO_PMIC_ARB_HW_VERSION_ADDR A:0x6200f000
y.create.l HWIO_PMIC_ARB_MISC_CONFIG_ADDR A:0x6200f004
y.create.l HWIO_PMIC_ARB_PVC_INTF_CTL_ADDR A:0x6200f008
y.create.l HWIO_PMIC_ARB_PVC_INTF_STATUS_ADDR A:0x6200f00c
y.create.l HWIO_PMIC_ARB_PRIORITIES0_ADDR A:0x6200f100
y.create.l HWIO_PMIC_ARB_PRIORITIES1_ADDR A:0x6200f104
y.create.l HWIO_PMIC_ARB_PRIORITIES2_ADDR A:0x6200f108
y.create.l HWIO_PMIC_ARB_PRIORITIES3_ADDR A:0x6200f10c
y.create.l HWIO_PMIC_ARB_PRIORITIES4_ADDR A:0x6200f110
y.create.l HWIO_PMIC_ARB_PRIORITIES5_ADDR A:0x6200f114
y.create.l HWIO_PMIC_ARB_PRIORITIES6_ADDR A:0x6200f118
y.create.l HWIO_PMIC_ARB_PVC_PORT0_CTL_ADDR A:0x6200f200
y.create.l HWIO_PMIC_ARB_PVC_PORT1_CTL_ADDR A:0x6200f204
y.create.l HWIO_PMIC_ARB_PVC_PORT2_CTL_ADDR A:0x6200f208
y.create.l HWIO_PMIC_ARB_PVC_PORT3_CTL_ADDR A:0x6200f20c
y.create.l HWIO_PMIC_ARB_PVC_PORT4_CTL_ADDR A:0x6200f210
y.create.l HWIO_PMIC_ARB_PVC_PORT5_CTL_ADDR A:0x6200f214
y.create.l HWIO_PMIC_ARB_PVC_PORT0_STATUS_ADDR A:0x6200f280
y.create.l HWIO_PMIC_ARB_PVC_PORT1_STATUS_ADDR A:0x6200f284
y.create.l HWIO_PMIC_ARB_PVC_PORT2_STATUS_ADDR A:0x6200f288
y.create.l HWIO_PMIC_ARB_PVC_PORT3_STATUS_ADDR A:0x6200f28c
y.create.l HWIO_PMIC_ARB_PVC_PORT4_STATUS_ADDR A:0x6200f290
y.create.l HWIO_PMIC_ARB_PVC_PORT5_STATUS_ADDR A:0x6200f294
y.create.l HWIO_PMIC_ARB_PVC0_ADDR0_ADDR A:0x6200f400
y.create.l HWIO_PMIC_ARB_PVC0_ADDR1_ADDR A:0x6200f404
y.create.l HWIO_PMIC_ARB_PVC0_ADDR2_ADDR A:0x6200f408
y.create.l HWIO_PMIC_ARB_PVC0_ADDR3_ADDR A:0x6200f40c
y.create.l HWIO_PMIC_ARB_PVC1_ADDR0_ADDR A:0x6200f420
y.create.l HWIO_PMIC_ARB_PVC1_ADDR1_ADDR A:0x6200f424
y.create.l HWIO_PMIC_ARB_PVC1_ADDR2_ADDR A:0x6200f428
y.create.l HWIO_PMIC_ARB_PVC1_ADDR3_ADDR A:0x6200f42c
y.create.l HWIO_PMIC_ARB_PVC2_ADDR0_ADDR A:0x6200f440
y.create.l HWIO_PMIC_ARB_PVC2_ADDR1_ADDR A:0x6200f444
y.create.l HWIO_PMIC_ARB_PVC2_ADDR2_ADDR A:0x6200f448
y.create.l HWIO_PMIC_ARB_PVC2_ADDR3_ADDR A:0x6200f44c
y.create.l HWIO_PMIC_ARB_PVC3_ADDR0_ADDR A:0x6200f460
y.create.l HWIO_PMIC_ARB_PVC3_ADDR1_ADDR A:0x6200f464
y.create.l HWIO_PMIC_ARB_PVC3_ADDR2_ADDR A:0x6200f468
y.create.l HWIO_PMIC_ARB_PVC3_ADDR3_ADDR A:0x6200f46c
y.create.l HWIO_PMIC_ARB_PVC4_ADDR0_ADDR A:0x6200f480
y.create.l HWIO_PMIC_ARB_PVC4_ADDR1_ADDR A:0x6200f484
y.create.l HWIO_PMIC_ARB_PVC4_ADDR2_ADDR A:0x6200f488
y.create.l HWIO_PMIC_ARB_PVC4_ADDR3_ADDR A:0x6200f48c
y.create.l HWIO_PMIC_ARB_PVC5_ADDR0_ADDR A:0x6200f4a0
y.create.l HWIO_PMIC_ARB_PVC5_ADDR1_ADDR A:0x6200f4a4
y.create.l HWIO_PMIC_ARB_PVC5_ADDR2_ADDR A:0x6200f4a8
y.create.l HWIO_PMIC_ARB_PVC5_ADDR3_ADDR A:0x6200f4ac
y.create.l HWIO_PMIC_ARB_REG_CHNL0_ADDR A:0x6200f800
y.create.l HWIO_PMIC_ARB_REG_CHNL1_ADDR A:0x6200f804
y.create.l HWIO_PMIC_ARB_REG_CHNL2_ADDR A:0x6200f808
y.create.l HWIO_PMIC_ARB_REG_CHNL3_ADDR A:0x6200f80c
y.create.l HWIO_PMIC_ARB_REG_CHNL4_ADDR A:0x6200f810
y.create.l HWIO_PMIC_ARB_REG_CHNL5_ADDR A:0x6200f814
y.create.l HWIO_PMIC_ARB_REG_CHNL6_ADDR A:0x6200f818
y.create.l HWIO_PMIC_ARB_REG_CHNL7_ADDR A:0x6200f81c
y.create.l HWIO_PMIC_ARB_REG_CHNL8_ADDR A:0x6200f820
y.create.l HWIO_PMIC_ARB_REG_CHNL9_ADDR A:0x6200f824
y.create.l HWIO_PMIC_ARB0_CHNL0_CMD_ADDR A:0x62400000
y.create.l HWIO_PMIC_ARB0_CHNL1_CMD_ADDR A:0x62408000
y.create.l HWIO_PMIC_ARB0_CHNL2_CMD_ADDR A:0x62410000
y.create.l HWIO_PMIC_ARB0_CHNL3_CMD_ADDR A:0x62418000
y.create.l HWIO_PMIC_ARB1_CHNL0_CMD_ADDR A:0x62401000
y.create.l HWIO_PMIC_ARB1_CHNL1_CMD_ADDR A:0x62409000
y.create.l HWIO_PMIC_ARB1_CHNL2_CMD_ADDR A:0x62411000
y.create.l HWIO_PMIC_ARB1_CHNL3_CMD_ADDR A:0x62419000
y.create.l HWIO_PMIC_ARB2_CHNL0_CMD_ADDR A:0x62402000
y.create.l HWIO_PMIC_ARB2_CHNL1_CMD_ADDR A:0x6240a000
y.create.l HWIO_PMIC_ARB2_CHNL2_CMD_ADDR A:0x62412000
y.create.l HWIO_PMIC_ARB2_CHNL3_CMD_ADDR A:0x6241a000
y.create.l HWIO_PMIC_ARB3_CHNL0_CMD_ADDR A:0x62403000
y.create.l HWIO_PMIC_ARB3_CHNL1_CMD_ADDR A:0x6240b000
y.create.l HWIO_PMIC_ARB3_CHNL2_CMD_ADDR A:0x62413000
y.create.l HWIO_PMIC_ARB3_CHNL3_CMD_ADDR A:0x6241b000
y.create.l HWIO_PMIC_ARB4_CHNL0_CMD_ADDR A:0x62404000
y.create.l HWIO_PMIC_ARB4_CHNL1_CMD_ADDR A:0x6240c000
y.create.l HWIO_PMIC_ARB4_CHNL2_CMD_ADDR A:0x62414000
y.create.l HWIO_PMIC_ARB4_CHNL3_CMD_ADDR A:0x6241c000
y.create.l HWIO_PMIC_ARB5_CHNL0_CMD_ADDR A:0x62405000
y.create.l HWIO_PMIC_ARB5_CHNL1_CMD_ADDR A:0x6240d000
y.create.l HWIO_PMIC_ARB5_CHNL2_CMD_ADDR A:0x62415000
y.create.l HWIO_PMIC_ARB5_CHNL3_CMD_ADDR A:0x6241d000
y.create.l HWIO_PMIC_ARB0_CHNL0_CONFIG_ADDR A:0x62400004
y.create.l HWIO_PMIC_ARB0_CHNL1_CONFIG_ADDR A:0x62408004
y.create.l HWIO_PMIC_ARB0_CHNL2_CONFIG_ADDR A:0x62410004
y.create.l HWIO_PMIC_ARB0_CHNL3_CONFIG_ADDR A:0x62418004
y.create.l HWIO_PMIC_ARB1_CHNL0_CONFIG_ADDR A:0x62401004
y.create.l HWIO_PMIC_ARB1_CHNL1_CONFIG_ADDR A:0x62409004
y.create.l HWIO_PMIC_ARB1_CHNL2_CONFIG_ADDR A:0x62411004
y.create.l HWIO_PMIC_ARB1_CHNL3_CONFIG_ADDR A:0x62419004
y.create.l HWIO_PMIC_ARB2_CHNL0_CONFIG_ADDR A:0x62402004
y.create.l HWIO_PMIC_ARB2_CHNL1_CONFIG_ADDR A:0x6240a004
y.create.l HWIO_PMIC_ARB2_CHNL2_CONFIG_ADDR A:0x62412004
y.create.l HWIO_PMIC_ARB2_CHNL3_CONFIG_ADDR A:0x6241a004
y.create.l HWIO_PMIC_ARB3_CHNL0_CONFIG_ADDR A:0x62403004
y.create.l HWIO_PMIC_ARB3_CHNL1_CONFIG_ADDR A:0x6240b004
y.create.l HWIO_PMIC_ARB3_CHNL2_CONFIG_ADDR A:0x62413004
y.create.l HWIO_PMIC_ARB3_CHNL3_CONFIG_ADDR A:0x6241b004
y.create.l HWIO_PMIC_ARB4_CHNL0_CONFIG_ADDR A:0x62404004
y.create.l HWIO_PMIC_ARB4_CHNL1_CONFIG_ADDR A:0x6240c004
y.create.l HWIO_PMIC_ARB4_CHNL2_CONFIG_ADDR A:0x62414004
y.create.l HWIO_PMIC_ARB4_CHNL3_CONFIG_ADDR A:0x6241c004
y.create.l HWIO_PMIC_ARB5_CHNL0_CONFIG_ADDR A:0x62405004
y.create.l HWIO_PMIC_ARB5_CHNL1_CONFIG_ADDR A:0x6240d004
y.create.l HWIO_PMIC_ARB5_CHNL2_CONFIG_ADDR A:0x62415004
y.create.l HWIO_PMIC_ARB5_CHNL3_CONFIG_ADDR A:0x6241d004
y.create.l HWIO_PMIC_ARB0_CHNL0_STATUS_ADDR A:0x62400008
y.create.l HWIO_PMIC_ARB0_CHNL1_STATUS_ADDR A:0x62408008
y.create.l HWIO_PMIC_ARB0_CHNL2_STATUS_ADDR A:0x62410008
y.create.l HWIO_PMIC_ARB0_CHNL3_STATUS_ADDR A:0x62418008
y.create.l HWIO_PMIC_ARB1_CHNL0_STATUS_ADDR A:0x62401008
y.create.l HWIO_PMIC_ARB1_CHNL1_STATUS_ADDR A:0x62409008
y.create.l HWIO_PMIC_ARB1_CHNL2_STATUS_ADDR A:0x62411008
y.create.l HWIO_PMIC_ARB1_CHNL3_STATUS_ADDR A:0x62419008
y.create.l HWIO_PMIC_ARB2_CHNL0_STATUS_ADDR A:0x62402008
y.create.l HWIO_PMIC_ARB2_CHNL1_STATUS_ADDR A:0x6240a008
y.create.l HWIO_PMIC_ARB2_CHNL2_STATUS_ADDR A:0x62412008
y.create.l HWIO_PMIC_ARB2_CHNL3_STATUS_ADDR A:0x6241a008
y.create.l HWIO_PMIC_ARB3_CHNL0_STATUS_ADDR A:0x62403008
y.create.l HWIO_PMIC_ARB3_CHNL1_STATUS_ADDR A:0x6240b008
y.create.l HWIO_PMIC_ARB3_CHNL2_STATUS_ADDR A:0x62413008
y.create.l HWIO_PMIC_ARB3_CHNL3_STATUS_ADDR A:0x6241b008
y.create.l HWIO_PMIC_ARB4_CHNL0_STATUS_ADDR A:0x62404008
y.create.l HWIO_PMIC_ARB4_CHNL1_STATUS_ADDR A:0x6240c008
y.create.l HWIO_PMIC_ARB4_CHNL2_STATUS_ADDR A:0x62414008
y.create.l HWIO_PMIC_ARB4_CHNL3_STATUS_ADDR A:0x6241c008
y.create.l HWIO_PMIC_ARB5_CHNL0_STATUS_ADDR A:0x62405008
y.create.l HWIO_PMIC_ARB5_CHNL1_STATUS_ADDR A:0x6240d008
y.create.l HWIO_PMIC_ARB5_CHNL2_STATUS_ADDR A:0x62415008
y.create.l HWIO_PMIC_ARB5_CHNL3_STATUS_ADDR A:0x6241d008
y.create.l HWIO_PMIC_ARB0_CHNL0_WDATA0_ADDR A:0x62400010
y.create.l HWIO_PMIC_ARB0_CHNL1_WDATA0_ADDR A:0x62408010
y.create.l HWIO_PMIC_ARB0_CHNL2_WDATA0_ADDR A:0x62410010
y.create.l HWIO_PMIC_ARB0_CHNL3_WDATA0_ADDR A:0x62418010
y.create.l HWIO_PMIC_ARB1_CHNL0_WDATA0_ADDR A:0x62401010
y.create.l HWIO_PMIC_ARB1_CHNL1_WDATA0_ADDR A:0x62409010
y.create.l HWIO_PMIC_ARB1_CHNL2_WDATA0_ADDR A:0x62411010
y.create.l HWIO_PMIC_ARB1_CHNL3_WDATA0_ADDR A:0x62419010
y.create.l HWIO_PMIC_ARB2_CHNL0_WDATA0_ADDR A:0x62402010
y.create.l HWIO_PMIC_ARB2_CHNL1_WDATA0_ADDR A:0x6240a010
y.create.l HWIO_PMIC_ARB2_CHNL2_WDATA0_ADDR A:0x62412010
y.create.l HWIO_PMIC_ARB2_CHNL3_WDATA0_ADDR A:0x6241a010
y.create.l HWIO_PMIC_ARB3_CHNL0_WDATA0_ADDR A:0x62403010
y.create.l HWIO_PMIC_ARB3_CHNL1_WDATA0_ADDR A:0x6240b010
y.create.l HWIO_PMIC_ARB3_CHNL2_WDATA0_ADDR A:0x62413010
y.create.l HWIO_PMIC_ARB3_CHNL3_WDATA0_ADDR A:0x6241b010
y.create.l HWIO_PMIC_ARB4_CHNL0_WDATA0_ADDR A:0x62404010
y.create.l HWIO_PMIC_ARB4_CHNL1_WDATA0_ADDR A:0x6240c010
y.create.l HWIO_PMIC_ARB4_CHNL2_WDATA0_ADDR A:0x62414010
y.create.l HWIO_PMIC_ARB4_CHNL3_WDATA0_ADDR A:0x6241c010
y.create.l HWIO_PMIC_ARB5_CHNL0_WDATA0_ADDR A:0x62405010
y.create.l HWIO_PMIC_ARB5_CHNL1_WDATA0_ADDR A:0x6240d010
y.create.l HWIO_PMIC_ARB5_CHNL2_WDATA0_ADDR A:0x62415010
y.create.l HWIO_PMIC_ARB5_CHNL3_WDATA0_ADDR A:0x6241d010
y.create.l HWIO_PMIC_ARB0_CHNL0_WDATA1_ADDR A:0x62400014
y.create.l HWIO_PMIC_ARB0_CHNL1_WDATA1_ADDR A:0x62408014
y.create.l HWIO_PMIC_ARB0_CHNL2_WDATA1_ADDR A:0x62410014
y.create.l HWIO_PMIC_ARB0_CHNL3_WDATA1_ADDR A:0x62418014
y.create.l HWIO_PMIC_ARB1_CHNL0_WDATA1_ADDR A:0x62401014
y.create.l HWIO_PMIC_ARB1_CHNL1_WDATA1_ADDR A:0x62409014
y.create.l HWIO_PMIC_ARB1_CHNL2_WDATA1_ADDR A:0x62411014
y.create.l HWIO_PMIC_ARB1_CHNL3_WDATA1_ADDR A:0x62419014
y.create.l HWIO_PMIC_ARB2_CHNL0_WDATA1_ADDR A:0x62402014
y.create.l HWIO_PMIC_ARB2_CHNL1_WDATA1_ADDR A:0x6240a014
y.create.l HWIO_PMIC_ARB2_CHNL2_WDATA1_ADDR A:0x62412014
y.create.l HWIO_PMIC_ARB2_CHNL3_WDATA1_ADDR A:0x6241a014
y.create.l HWIO_PMIC_ARB3_CHNL0_WDATA1_ADDR A:0x62403014
y.create.l HWIO_PMIC_ARB3_CHNL1_WDATA1_ADDR A:0x6240b014
y.create.l HWIO_PMIC_ARB3_CHNL2_WDATA1_ADDR A:0x62413014
y.create.l HWIO_PMIC_ARB3_CHNL3_WDATA1_ADDR A:0x6241b014
y.create.l HWIO_PMIC_ARB4_CHNL0_WDATA1_ADDR A:0x62404014
y.create.l HWIO_PMIC_ARB4_CHNL1_WDATA1_ADDR A:0x6240c014
y.create.l HWIO_PMIC_ARB4_CHNL2_WDATA1_ADDR A:0x62414014
y.create.l HWIO_PMIC_ARB4_CHNL3_WDATA1_ADDR A:0x6241c014
y.create.l HWIO_PMIC_ARB5_CHNL0_WDATA1_ADDR A:0x62405014
y.create.l HWIO_PMIC_ARB5_CHNL1_WDATA1_ADDR A:0x6240d014
y.create.l HWIO_PMIC_ARB5_CHNL2_WDATA1_ADDR A:0x62415014
y.create.l HWIO_PMIC_ARB5_CHNL3_WDATA1_ADDR A:0x6241d014
y.create.l HWIO_PMIC_ARB0_CHNL0_RDATA0_ADDR A:0x62400018
y.create.l HWIO_PMIC_ARB0_CHNL1_RDATA0_ADDR A:0x62408018
y.create.l HWIO_PMIC_ARB0_CHNL2_RDATA0_ADDR A:0x62410018
y.create.l HWIO_PMIC_ARB0_CHNL3_RDATA0_ADDR A:0x62418018
y.create.l HWIO_PMIC_ARB1_CHNL0_RDATA0_ADDR A:0x62401018
y.create.l HWIO_PMIC_ARB1_CHNL1_RDATA0_ADDR A:0x62409018
y.create.l HWIO_PMIC_ARB1_CHNL2_RDATA0_ADDR A:0x62411018
y.create.l HWIO_PMIC_ARB1_CHNL3_RDATA0_ADDR A:0x62419018
y.create.l HWIO_PMIC_ARB2_CHNL0_RDATA0_ADDR A:0x62402018
y.create.l HWIO_PMIC_ARB2_CHNL1_RDATA0_ADDR A:0x6240a018
y.create.l HWIO_PMIC_ARB2_CHNL2_RDATA0_ADDR A:0x62412018
y.create.l HWIO_PMIC_ARB2_CHNL3_RDATA0_ADDR A:0x6241a018
y.create.l HWIO_PMIC_ARB3_CHNL0_RDATA0_ADDR A:0x62403018
y.create.l HWIO_PMIC_ARB3_CHNL1_RDATA0_ADDR A:0x6240b018
y.create.l HWIO_PMIC_ARB3_CHNL2_RDATA0_ADDR A:0x62413018
y.create.l HWIO_PMIC_ARB3_CHNL3_RDATA0_ADDR A:0x6241b018
y.create.l HWIO_PMIC_ARB4_CHNL0_RDATA0_ADDR A:0x62404018
y.create.l HWIO_PMIC_ARB4_CHNL1_RDATA0_ADDR A:0x6240c018
y.create.l HWIO_PMIC_ARB4_CHNL2_RDATA0_ADDR A:0x62414018
y.create.l HWIO_PMIC_ARB4_CHNL3_RDATA0_ADDR A:0x6241c018
y.create.l HWIO_PMIC_ARB5_CHNL0_RDATA0_ADDR A:0x62405018
y.create.l HWIO_PMIC_ARB5_CHNL1_RDATA0_ADDR A:0x6240d018
y.create.l HWIO_PMIC_ARB5_CHNL2_RDATA0_ADDR A:0x62415018
y.create.l HWIO_PMIC_ARB5_CHNL3_RDATA0_ADDR A:0x6241d018
y.create.l HWIO_PMIC_ARB0_CHNL0_RDATA1_ADDR A:0x6240001c
y.create.l HWIO_PMIC_ARB0_CHNL1_RDATA1_ADDR A:0x6240801c
y.create.l HWIO_PMIC_ARB0_CHNL2_RDATA1_ADDR A:0x6241001c
y.create.l HWIO_PMIC_ARB0_CHNL3_RDATA1_ADDR A:0x6241801c
y.create.l HWIO_PMIC_ARB1_CHNL0_RDATA1_ADDR A:0x6240101c
y.create.l HWIO_PMIC_ARB1_CHNL1_RDATA1_ADDR A:0x6240901c
y.create.l HWIO_PMIC_ARB1_CHNL2_RDATA1_ADDR A:0x6241101c
y.create.l HWIO_PMIC_ARB1_CHNL3_RDATA1_ADDR A:0x6241901c
y.create.l HWIO_PMIC_ARB2_CHNL0_RDATA1_ADDR A:0x6240201c
y.create.l HWIO_PMIC_ARB2_CHNL1_RDATA1_ADDR A:0x6240a01c
y.create.l HWIO_PMIC_ARB2_CHNL2_RDATA1_ADDR A:0x6241201c
y.create.l HWIO_PMIC_ARB2_CHNL3_RDATA1_ADDR A:0x6241a01c
y.create.l HWIO_PMIC_ARB3_CHNL0_RDATA1_ADDR A:0x6240301c
y.create.l HWIO_PMIC_ARB3_CHNL1_RDATA1_ADDR A:0x6240b01c
y.create.l HWIO_PMIC_ARB3_CHNL2_RDATA1_ADDR A:0x6241301c
y.create.l HWIO_PMIC_ARB3_CHNL3_RDATA1_ADDR A:0x6241b01c
y.create.l HWIO_PMIC_ARB4_CHNL0_RDATA1_ADDR A:0x6240401c
y.create.l HWIO_PMIC_ARB4_CHNL1_RDATA1_ADDR A:0x6240c01c
y.create.l HWIO_PMIC_ARB4_CHNL2_RDATA1_ADDR A:0x6241401c
y.create.l HWIO_PMIC_ARB4_CHNL3_RDATA1_ADDR A:0x6241c01c
y.create.l HWIO_PMIC_ARB5_CHNL0_RDATA1_ADDR A:0x6240501c
y.create.l HWIO_PMIC_ARB5_CHNL1_RDATA1_ADDR A:0x6240d01c
y.create.l HWIO_PMIC_ARB5_CHNL2_RDATA1_ADDR A:0x6241501c
y.create.l HWIO_PMIC_ARB5_CHNL3_RDATA1_ADDR A:0x6241d01c
y.create.l HWIO_PMIC_ARB0_CHNL0_RDATA2_ADDR A:0x62400020
y.create.l HWIO_PMIC_ARB0_CHNL1_RDATA2_ADDR A:0x62408020
y.create.l HWIO_PMIC_ARB0_CHNL2_RDATA2_ADDR A:0x62410020
y.create.l HWIO_PMIC_ARB0_CHNL3_RDATA2_ADDR A:0x62418020
y.create.l HWIO_PMIC_ARB1_CHNL0_RDATA2_ADDR A:0x62401020
y.create.l HWIO_PMIC_ARB1_CHNL1_RDATA2_ADDR A:0x62409020
y.create.l HWIO_PMIC_ARB1_CHNL2_RDATA2_ADDR A:0x62411020
y.create.l HWIO_PMIC_ARB1_CHNL3_RDATA2_ADDR A:0x62419020
y.create.l HWIO_PMIC_ARB2_CHNL0_RDATA2_ADDR A:0x62402020
y.create.l HWIO_PMIC_ARB2_CHNL1_RDATA2_ADDR A:0x6240a020
y.create.l HWIO_PMIC_ARB2_CHNL2_RDATA2_ADDR A:0x62412020
y.create.l HWIO_PMIC_ARB2_CHNL3_RDATA2_ADDR A:0x6241a020
y.create.l HWIO_PMIC_ARB3_CHNL0_RDATA2_ADDR A:0x62403020
y.create.l HWIO_PMIC_ARB3_CHNL1_RDATA2_ADDR A:0x6240b020
y.create.l HWIO_PMIC_ARB3_CHNL2_RDATA2_ADDR A:0x62413020
y.create.l HWIO_PMIC_ARB3_CHNL3_RDATA2_ADDR A:0x6241b020
y.create.l HWIO_PMIC_ARB4_CHNL0_RDATA2_ADDR A:0x62404020
y.create.l HWIO_PMIC_ARB4_CHNL1_RDATA2_ADDR A:0x6240c020
y.create.l HWIO_PMIC_ARB4_CHNL2_RDATA2_ADDR A:0x62414020
y.create.l HWIO_PMIC_ARB4_CHNL3_RDATA2_ADDR A:0x6241c020
y.create.l HWIO_PMIC_ARB5_CHNL0_RDATA2_ADDR A:0x62405020
y.create.l HWIO_PMIC_ARB5_CHNL1_RDATA2_ADDR A:0x6240d020
y.create.l HWIO_PMIC_ARB5_CHNL2_RDATA2_ADDR A:0x62415020
y.create.l HWIO_PMIC_ARB5_CHNL3_RDATA2_ADDR A:0x6241d020
y.create.l HWIO_PMIC_ARB_OBS0_CHNL0_CMD_ADDR A:0x62c00000
y.create.l HWIO_PMIC_ARB_OBS0_CHNL1_CMD_ADDR A:0x62c08000
y.create.l HWIO_PMIC_ARB_OBS0_CHNL2_CMD_ADDR A:0x62c10000
y.create.l HWIO_PMIC_ARB_OBS0_CHNL3_CMD_ADDR A:0x62c18000
y.create.l HWIO_PMIC_ARB_OBS1_CHNL0_CMD_ADDR A:0x62c01000
y.create.l HWIO_PMIC_ARB_OBS1_CHNL1_CMD_ADDR A:0x62c09000
y.create.l HWIO_PMIC_ARB_OBS1_CHNL2_CMD_ADDR A:0x62c11000
y.create.l HWIO_PMIC_ARB_OBS1_CHNL3_CMD_ADDR A:0x62c19000
y.create.l HWIO_PMIC_ARB_OBS2_CHNL0_CMD_ADDR A:0x62c02000
y.create.l HWIO_PMIC_ARB_OBS2_CHNL1_CMD_ADDR A:0x62c0a000
y.create.l HWIO_PMIC_ARB_OBS2_CHNL2_CMD_ADDR A:0x62c12000
y.create.l HWIO_PMIC_ARB_OBS2_CHNL3_CMD_ADDR A:0x62c1a000
y.create.l HWIO_PMIC_ARB_OBS3_CHNL0_CMD_ADDR A:0x62c03000
y.create.l HWIO_PMIC_ARB_OBS3_CHNL1_CMD_ADDR A:0x62c0b000
y.create.l HWIO_PMIC_ARB_OBS3_CHNL2_CMD_ADDR A:0x62c13000
y.create.l HWIO_PMIC_ARB_OBS3_CHNL3_CMD_ADDR A:0x62c1b000
y.create.l HWIO_PMIC_ARB_OBS4_CHNL0_CMD_ADDR A:0x62c04000
y.create.l HWIO_PMIC_ARB_OBS4_CHNL1_CMD_ADDR A:0x62c0c000
y.create.l HWIO_PMIC_ARB_OBS4_CHNL2_CMD_ADDR A:0x62c14000
y.create.l HWIO_PMIC_ARB_OBS4_CHNL3_CMD_ADDR A:0x62c1c000
y.create.l HWIO_PMIC_ARB_OBS5_CHNL0_CMD_ADDR A:0x62c05000
y.create.l HWIO_PMIC_ARB_OBS5_CHNL1_CMD_ADDR A:0x62c0d000
y.create.l HWIO_PMIC_ARB_OBS5_CHNL2_CMD_ADDR A:0x62c15000
y.create.l HWIO_PMIC_ARB_OBS5_CHNL3_CMD_ADDR A:0x62c1d000
y.create.l HWIO_PMIC_ARB_OBS0_CHNL0_CONFIG_ADDR A:0x62c00004
y.create.l HWIO_PMIC_ARB_OBS0_CHNL1_CONFIG_ADDR A:0x62c08004
y.create.l HWIO_PMIC_ARB_OBS0_CHNL2_CONFIG_ADDR A:0x62c10004
y.create.l HWIO_PMIC_ARB_OBS0_CHNL3_CONFIG_ADDR A:0x62c18004
y.create.l HWIO_PMIC_ARB_OBS1_CHNL0_CONFIG_ADDR A:0x62c01004
y.create.l HWIO_PMIC_ARB_OBS1_CHNL1_CONFIG_ADDR A:0x62c09004
y.create.l HWIO_PMIC_ARB_OBS1_CHNL2_CONFIG_ADDR A:0x62c11004
y.create.l HWIO_PMIC_ARB_OBS1_CHNL3_CONFIG_ADDR A:0x62c19004
y.create.l HWIO_PMIC_ARB_OBS2_CHNL0_CONFIG_ADDR A:0x62c02004
y.create.l HWIO_PMIC_ARB_OBS2_CHNL1_CONFIG_ADDR A:0x62c0a004
y.create.l HWIO_PMIC_ARB_OBS2_CHNL2_CONFIG_ADDR A:0x62c12004
y.create.l HWIO_PMIC_ARB_OBS2_CHNL3_CONFIG_ADDR A:0x62c1a004
y.create.l HWIO_PMIC_ARB_OBS3_CHNL0_CONFIG_ADDR A:0x62c03004
y.create.l HWIO_PMIC_ARB_OBS3_CHNL1_CONFIG_ADDR A:0x62c0b004
y.create.l HWIO_PMIC_ARB_OBS3_CHNL2_CONFIG_ADDR A:0x62c13004
y.create.l HWIO_PMIC_ARB_OBS3_CHNL3_CONFIG_ADDR A:0x62c1b004
y.create.l HWIO_PMIC_ARB_OBS4_CHNL0_CONFIG_ADDR A:0x62c04004
y.create.l HWIO_PMIC_ARB_OBS4_CHNL1_CONFIG_ADDR A:0x62c0c004
y.create.l HWIO_PMIC_ARB_OBS4_CHNL2_CONFIG_ADDR A:0x62c14004
y.create.l HWIO_PMIC_ARB_OBS4_CHNL3_CONFIG_ADDR A:0x62c1c004
y.create.l HWIO_PMIC_ARB_OBS5_CHNL0_CONFIG_ADDR A:0x62c05004
y.create.l HWIO_PMIC_ARB_OBS5_CHNL1_CONFIG_ADDR A:0x62c0d004
y.create.l HWIO_PMIC_ARB_OBS5_CHNL2_CONFIG_ADDR A:0x62c15004
y.create.l HWIO_PMIC_ARB_OBS5_CHNL3_CONFIG_ADDR A:0x62c1d004
y.create.l HWIO_PMIC_ARB_OBS0_CHNL0_STATUS_ADDR A:0x62c00008
y.create.l HWIO_PMIC_ARB_OBS0_CHNL1_STATUS_ADDR A:0x62c08008
y.create.l HWIO_PMIC_ARB_OBS0_CHNL2_STATUS_ADDR A:0x62c10008
y.create.l HWIO_PMIC_ARB_OBS0_CHNL3_STATUS_ADDR A:0x62c18008
y.create.l HWIO_PMIC_ARB_OBS1_CHNL0_STATUS_ADDR A:0x62c01008
y.create.l HWIO_PMIC_ARB_OBS1_CHNL1_STATUS_ADDR A:0x62c09008
y.create.l HWIO_PMIC_ARB_OBS1_CHNL2_STATUS_ADDR A:0x62c11008
y.create.l HWIO_PMIC_ARB_OBS1_CHNL3_STATUS_ADDR A:0x62c19008
y.create.l HWIO_PMIC_ARB_OBS2_CHNL0_STATUS_ADDR A:0x62c02008
y.create.l HWIO_PMIC_ARB_OBS2_CHNL1_STATUS_ADDR A:0x62c0a008
y.create.l HWIO_PMIC_ARB_OBS2_CHNL2_STATUS_ADDR A:0x62c12008
y.create.l HWIO_PMIC_ARB_OBS2_CHNL3_STATUS_ADDR A:0x62c1a008
y.create.l HWIO_PMIC_ARB_OBS3_CHNL0_STATUS_ADDR A:0x62c03008
y.create.l HWIO_PMIC_ARB_OBS3_CHNL1_STATUS_ADDR A:0x62c0b008
y.create.l HWIO_PMIC_ARB_OBS3_CHNL2_STATUS_ADDR A:0x62c13008
y.create.l HWIO_PMIC_ARB_OBS3_CHNL3_STATUS_ADDR A:0x62c1b008
y.create.l HWIO_PMIC_ARB_OBS4_CHNL0_STATUS_ADDR A:0x62c04008
y.create.l HWIO_PMIC_ARB_OBS4_CHNL1_STATUS_ADDR A:0x62c0c008
y.create.l HWIO_PMIC_ARB_OBS4_CHNL2_STATUS_ADDR A:0x62c14008
y.create.l HWIO_PMIC_ARB_OBS4_CHNL3_STATUS_ADDR A:0x62c1c008
y.create.l HWIO_PMIC_ARB_OBS5_CHNL0_STATUS_ADDR A:0x62c05008
y.create.l HWIO_PMIC_ARB_OBS5_CHNL1_STATUS_ADDR A:0x62c0d008
y.create.l HWIO_PMIC_ARB_OBS5_CHNL2_STATUS_ADDR A:0x62c15008
y.create.l HWIO_PMIC_ARB_OBS5_CHNL3_STATUS_ADDR A:0x62c1d008
y.create.l HWIO_PMIC_ARB_OBS0_CHNL0_RDATA0_ADDR A:0x62c00018
y.create.l HWIO_PMIC_ARB_OBS0_CHNL1_RDATA0_ADDR A:0x62c08018
y.create.l HWIO_PMIC_ARB_OBS0_CHNL2_RDATA0_ADDR A:0x62c10018
y.create.l HWIO_PMIC_ARB_OBS0_CHNL3_RDATA0_ADDR A:0x62c18018
y.create.l HWIO_PMIC_ARB_OBS1_CHNL0_RDATA0_ADDR A:0x62c01018
y.create.l HWIO_PMIC_ARB_OBS1_CHNL1_RDATA0_ADDR A:0x62c09018
y.create.l HWIO_PMIC_ARB_OBS1_CHNL2_RDATA0_ADDR A:0x62c11018
y.create.l HWIO_PMIC_ARB_OBS1_CHNL3_RDATA0_ADDR A:0x62c19018
y.create.l HWIO_PMIC_ARB_OBS2_CHNL0_RDATA0_ADDR A:0x62c02018
y.create.l HWIO_PMIC_ARB_OBS2_CHNL1_RDATA0_ADDR A:0x62c0a018
y.create.l HWIO_PMIC_ARB_OBS2_CHNL2_RDATA0_ADDR A:0x62c12018
y.create.l HWIO_PMIC_ARB_OBS2_CHNL3_RDATA0_ADDR A:0x62c1a018
y.create.l HWIO_PMIC_ARB_OBS3_CHNL0_RDATA0_ADDR A:0x62c03018
y.create.l HWIO_PMIC_ARB_OBS3_CHNL1_RDATA0_ADDR A:0x62c0b018
y.create.l HWIO_PMIC_ARB_OBS3_CHNL2_RDATA0_ADDR A:0x62c13018
y.create.l HWIO_PMIC_ARB_OBS3_CHNL3_RDATA0_ADDR A:0x62c1b018
y.create.l HWIO_PMIC_ARB_OBS4_CHNL0_RDATA0_ADDR A:0x62c04018
y.create.l HWIO_PMIC_ARB_OBS4_CHNL1_RDATA0_ADDR A:0x62c0c018
y.create.l HWIO_PMIC_ARB_OBS4_CHNL2_RDATA0_ADDR A:0x62c14018
y.create.l HWIO_PMIC_ARB_OBS4_CHNL3_RDATA0_ADDR A:0x62c1c018
y.create.l HWIO_PMIC_ARB_OBS5_CHNL0_RDATA0_ADDR A:0x62c05018
y.create.l HWIO_PMIC_ARB_OBS5_CHNL1_RDATA0_ADDR A:0x62c0d018
y.create.l HWIO_PMIC_ARB_OBS5_CHNL2_RDATA0_ADDR A:0x62c15018
y.create.l HWIO_PMIC_ARB_OBS5_CHNL3_RDATA0_ADDR A:0x62c1d018
y.create.l HWIO_PMIC_ARB_OBS0_CHNL0_RDATA1_ADDR A:0x62c0001c
y.create.l HWIO_PMIC_ARB_OBS0_CHNL1_RDATA1_ADDR A:0x62c0801c
y.create.l HWIO_PMIC_ARB_OBS0_CHNL2_RDATA1_ADDR A:0x62c1001c
y.create.l HWIO_PMIC_ARB_OBS0_CHNL3_RDATA1_ADDR A:0x62c1801c
y.create.l HWIO_PMIC_ARB_OBS1_CHNL0_RDATA1_ADDR A:0x62c0101c
y.create.l HWIO_PMIC_ARB_OBS1_CHNL1_RDATA1_ADDR A:0x62c0901c
y.create.l HWIO_PMIC_ARB_OBS1_CHNL2_RDATA1_ADDR A:0x62c1101c
y.create.l HWIO_PMIC_ARB_OBS1_CHNL3_RDATA1_ADDR A:0x62c1901c
y.create.l HWIO_PMIC_ARB_OBS2_CHNL0_RDATA1_ADDR A:0x62c0201c
y.create.l HWIO_PMIC_ARB_OBS2_CHNL1_RDATA1_ADDR A:0x62c0a01c
y.create.l HWIO_PMIC_ARB_OBS2_CHNL2_RDATA1_ADDR A:0x62c1201c
y.create.l HWIO_PMIC_ARB_OBS2_CHNL3_RDATA1_ADDR A:0x62c1a01c
y.create.l HWIO_PMIC_ARB_OBS3_CHNL0_RDATA1_ADDR A:0x62c0301c
y.create.l HWIO_PMIC_ARB_OBS3_CHNL1_RDATA1_ADDR A:0x62c0b01c
y.create.l HWIO_PMIC_ARB_OBS3_CHNL2_RDATA1_ADDR A:0x62c1301c
y.create.l HWIO_PMIC_ARB_OBS3_CHNL3_RDATA1_ADDR A:0x62c1b01c
y.create.l HWIO_PMIC_ARB_OBS4_CHNL0_RDATA1_ADDR A:0x62c0401c
y.create.l HWIO_PMIC_ARB_OBS4_CHNL1_RDATA1_ADDR A:0x62c0c01c
y.create.l HWIO_PMIC_ARB_OBS4_CHNL2_RDATA1_ADDR A:0x62c1401c
y.create.l HWIO_PMIC_ARB_OBS4_CHNL3_RDATA1_ADDR A:0x62c1c01c
y.create.l HWIO_PMIC_ARB_OBS5_CHNL0_RDATA1_ADDR A:0x62c0501c
y.create.l HWIO_PMIC_ARB_OBS5_CHNL1_RDATA1_ADDR A:0x62c0d01c
y.create.l HWIO_PMIC_ARB_OBS5_CHNL2_RDATA1_ADDR A:0x62c1501c
y.create.l HWIO_PMIC_ARB_OBS5_CHNL3_RDATA1_ADDR A:0x62c1d01c
y.create.l HWIO_PRNG_PRNG_DATA_OUT_ADDR A:0x60022000
y.create.l HWIO_PRNG_PRNG_STATUS_ADDR A:0x60022004
y.create.l HWIO_PRNG_PRNG_HW_VERSION_ADDR A:0x60022008
y.create.l HWIO_PRNG_PRNG_ENTROPY_CNTR_ADDR A:0x60022010
y.create.l HWIO_PRNG_PRNG_SAMPLE_CNTR_ADDR A:0x60022014
y.create.l HWIO_PRNG_PRNG_GEN_CNTR_ADDR A:0x60022018
y.create.l HWIO_PRNG_PRNG_RESEED_CNTR_ADDR A:0x6002201c
y.create.l HWIO_PRNG_PRNG_INSTANTIATE_CNTR_ADDR A:0x60022020
y.create.l HWIO_PRNG_PRNG_DEBUG_ADDR A:0x60022024
y.create.l HWIO_PRNG_PRNG_LFSR_CFG_ADDR A:0x60022100
y.create.l HWIO_PRNG_PRNG_CONFIG_ADDR A:0x60022104
y.create.l HWIO_PRNG_PRNG_PERSONALIZATION_STRING_ADDR A:0x60022108
y.create.l HWIO_PRNG_PRNG_NUM_ENTROPY_ADDR A:0x60022110
y.create.l HWIO_PRNG_PRNG_SAMPLE_FREQ_ADDR A:0x60022114
y.create.l HWIO_PRNG_PRNG_GEN_WORDS_ADDR A:0x60022118
y.create.l HWIO_PRNG_PRNG_RESEED_FREQ_ADDR A:0x6002211c
y.create.l HWIO_PRNG_PRNG_INSTANTIATE_FREQ_ADDR A:0x60022120
y.create.l HWIO_QDSS_AHB_DEC_NDPBAM_BAM_CTRL_ADDR A:0x60884000
y.create.l HWIO_QDSS_AHB_DEC_NDPBAM_BAM_TIMER_ADDR A:0x60884040
y.create.l HWIO_QDSS_AHB_DEC_NDPBAM_BAM_TIMER_CTRL_ADDR A:0x60884044
y.create.l HWIO_QDSS_AHB_DEC_NDPBAM_BAM_DESC_CNT_TRSHLD_ADDR A:0x60884008
y.create.l HWIO_QDSS_AHB_DEC_NDPBAM_BAM_IRQ_STTS_ADDR A:0x60884014
y.create.l HWIO_QDSS_AHB_DEC_NDPBAM_BAM_IRQ_CLR_ADDR A:0x60884018
y.create.l HWIO_QDSS_AHB_DEC_NDPBAM_BAM_IRQ_EN_ADDR A:0x6088401c
y.create.l HWIO_QDSS_AHB_DEC_NDPBAM_BAM_CNFG_BITS_ADDR A:0x6088407c
y.create.l HWIO_QDSS_AHB_DEC_NDPBAM_BAM_CNFG_BITS_2_ADDR A:0x60884084
y.create.l HWIO_QDSS_AHB_DEC_NDPBAM_BAM_REVISION_ADDR A:0x60885000
y.create.l HWIO_QDSS_AHB_DEC_NDPBAM_BAM_SW_VERSION_ADDR A:0x60885004
y.create.l HWIO_QDSS_AHB_DEC_NDPBAM_BAM_NUM_PIPES_ADDR A:0x60885008
y.create.l HWIO_QDSS_AHB_DEC_NDPBAM_BAM_TEST_BUS_SEL_ADDR A:0x60885010
y.create.l HWIO_QDSS_AHB_DEC_NDPBAM_BAM_TEST_BUS_REG_ADDR A:0x60885014
y.create.l HWIO_QDSS_AHB_DEC_NDPBAM_BAM_AHB_MASTER_ERR_CTRLS_ADDR A:0x60885024
y.create.l HWIO_QDSS_AHB_DEC_NDPBAM_BAM_AHB_MASTER_ERR_ADDR_ADDR A:0x60885028
y.create.l HWIO_QDSS_AHB_DEC_NDPBAM_BAM_AHB_MASTER_ERR_DATA_ADDR A:0x6088502c
y.create.l HWIO_QDSS_AHB_DEC_NDPBAM_BAM_AHB_MASTER_ERR_ADDR_LSB_ADDR A:0x60885100
y.create.l HWIO_QDSS_AHB_DEC_NDPBAM_BAM_AHB_MASTER_ERR_ADDR_MSB_ADDR A:0x60885104
y.create.l HWIO_QDSS_AHB_DEC_NDPBAM_BAM_TRUST_REG_ADDR A:0x60886000
y.create.l HWIO_QDSS_AHB_DEC_NDPBAM_BAM_P_TRUST_REG0_ADDR A:0x60886020
y.create.l HWIO_QDSS_AHB_DEC_NDPBAM_BAM_P_TRUST_REG1_ADDR A:0x60886024
y.create.l HWIO_QDSS_AHB_DEC_NDPBAM_BAM_IRQ_SRCS_EE0_ADDR A:0x60887000
y.create.l HWIO_QDSS_AHB_DEC_NDPBAM_BAM_IRQ_SRCS_EE1_ADDR A:0x60888000
y.create.l HWIO_QDSS_AHB_DEC_NDPBAM_BAM_IRQ_SRCS_EE2_ADDR A:0x60889000
y.create.l HWIO_QDSS_AHB_DEC_NDPBAM_BAM_IRQ_SRCS_EE3_ADDR A:0x6088a000
y.create.l HWIO_QDSS_AHB_DEC_NDPBAM_BAM_IRQ_SRCS_EE4_ADDR A:0x6088b000
y.create.l HWIO_QDSS_AHB_DEC_NDPBAM_BAM_IRQ_SRCS_EE5_ADDR A:0x6088c000
y.create.l HWIO_QDSS_AHB_DEC_NDPBAM_BAM_IRQ_SRCS_EE6_ADDR A:0x6088d000
y.create.l HWIO_QDSS_AHB_DEC_NDPBAM_BAM_IRQ_SRCS_EE7_ADDR A:0x6088e000
y.create.l HWIO_QDSS_AHB_DEC_NDPBAM_BAM_IRQ_SRCS_MSK_EE0_ADDR A:0x60887004
y.create.l HWIO_QDSS_AHB_DEC_NDPBAM_BAM_IRQ_SRCS_MSK_EE1_ADDR A:0x60888004
y.create.l HWIO_QDSS_AHB_DEC_NDPBAM_BAM_IRQ_SRCS_MSK_EE2_ADDR A:0x60889004
y.create.l HWIO_QDSS_AHB_DEC_NDPBAM_BAM_IRQ_SRCS_MSK_EE3_ADDR A:0x6088a004
y.create.l HWIO_QDSS_AHB_DEC_NDPBAM_BAM_IRQ_SRCS_MSK_EE4_ADDR A:0x6088b004
y.create.l HWIO_QDSS_AHB_DEC_NDPBAM_BAM_IRQ_SRCS_MSK_EE5_ADDR A:0x6088c004
y.create.l HWIO_QDSS_AHB_DEC_NDPBAM_BAM_IRQ_SRCS_MSK_EE6_ADDR A:0x6088d004
y.create.l HWIO_QDSS_AHB_DEC_NDPBAM_BAM_IRQ_SRCS_MSK_EE7_ADDR A:0x6088e004
y.create.l HWIO_QDSS_AHB_DEC_NDPBAM_BAM_IRQ_SRCS_UNMASKED_EE0_ADDR A:0x60887008
y.create.l HWIO_QDSS_AHB_DEC_NDPBAM_BAM_IRQ_SRCS_UNMASKED_EE1_ADDR A:0x60888008
y.create.l HWIO_QDSS_AHB_DEC_NDPBAM_BAM_IRQ_SRCS_UNMASKED_EE2_ADDR A:0x60889008
y.create.l HWIO_QDSS_AHB_DEC_NDPBAM_BAM_IRQ_SRCS_UNMASKED_EE3_ADDR A:0x6088a008
y.create.l HWIO_QDSS_AHB_DEC_NDPBAM_BAM_IRQ_SRCS_UNMASKED_EE4_ADDR A:0x6088b008
y.create.l HWIO_QDSS_AHB_DEC_NDPBAM_BAM_IRQ_SRCS_UNMASKED_EE5_ADDR A:0x6088c008
y.create.l HWIO_QDSS_AHB_DEC_NDPBAM_BAM_IRQ_SRCS_UNMASKED_EE6_ADDR A:0x6088d008
y.create.l HWIO_QDSS_AHB_DEC_NDPBAM_BAM_IRQ_SRCS_UNMASKED_EE7_ADDR A:0x6088e008
y.create.l HWIO_QDSS_AHB_DEC_NDPBAM_BAM_PIPE_ATTR_EE0_ADDR A:0x6088700c
y.create.l HWIO_QDSS_AHB_DEC_NDPBAM_BAM_PIPE_ATTR_EE1_ADDR A:0x6088800c
y.create.l HWIO_QDSS_AHB_DEC_NDPBAM_BAM_PIPE_ATTR_EE2_ADDR A:0x6088900c
y.create.l HWIO_QDSS_AHB_DEC_NDPBAM_BAM_PIPE_ATTR_EE3_ADDR A:0x6088a00c
y.create.l HWIO_QDSS_AHB_DEC_NDPBAM_BAM_PIPE_ATTR_EE4_ADDR A:0x6088b00c
y.create.l HWIO_QDSS_AHB_DEC_NDPBAM_BAM_PIPE_ATTR_EE5_ADDR A:0x6088c00c
y.create.l HWIO_QDSS_AHB_DEC_NDPBAM_BAM_PIPE_ATTR_EE6_ADDR A:0x6088d00c
y.create.l HWIO_QDSS_AHB_DEC_NDPBAM_BAM_PIPE_ATTR_EE7_ADDR A:0x6088e00c
y.create.l HWIO_QDSS_AHB_DEC_NDPBAM_BAM_IRQ_SRCS_ADDR A:0x60887010
y.create.l HWIO_QDSS_AHB_DEC_NDPBAM_BAM_IRQ_SRCS_MSK_ADDR A:0x60887014
y.create.l HWIO_QDSS_AHB_DEC_NDPBAM_BAM_IRQ_SRCS_UNMASKED_ADDR A:0x60887018
y.create.l HWIO_QDSS_AHB_DEC_NDPBAM_BAM_P_CTRL0_ADDR A:0x60897000
y.create.l HWIO_QDSS_AHB_DEC_NDPBAM_BAM_P_CTRL1_ADDR A:0x60898000
y.create.l HWIO_QDSS_AHB_DEC_NDPBAM_BAM_P_RST0_ADDR A:0x60897004
y.create.l HWIO_QDSS_AHB_DEC_NDPBAM_BAM_P_RST1_ADDR A:0x60898004
y.create.l HWIO_QDSS_AHB_DEC_NDPBAM_BAM_P_HALT0_ADDR A:0x60897008
y.create.l HWIO_QDSS_AHB_DEC_NDPBAM_BAM_P_HALT1_ADDR A:0x60898008
y.create.l HWIO_QDSS_AHB_DEC_NDPBAM_BAM_P_IRQ_STTS0_ADDR A:0x60897010
y.create.l HWIO_QDSS_AHB_DEC_NDPBAM_BAM_P_IRQ_STTS1_ADDR A:0x60898010
y.create.l HWIO_QDSS_AHB_DEC_NDPBAM_BAM_P_IRQ_CLR0_ADDR A:0x60897014
y.create.l HWIO_QDSS_AHB_DEC_NDPBAM_BAM_P_IRQ_CLR1_ADDR A:0x60898014
y.create.l HWIO_QDSS_AHB_DEC_NDPBAM_BAM_P_IRQ_EN0_ADDR A:0x60897018
y.create.l HWIO_QDSS_AHB_DEC_NDPBAM_BAM_P_IRQ_EN1_ADDR A:0x60898018
y.create.l HWIO_QDSS_AHB_DEC_NDPBAM_BAM_P_TIMER0_ADDR A:0x6089701c
y.create.l HWIO_QDSS_AHB_DEC_NDPBAM_BAM_P_TIMER1_ADDR A:0x6089801c
y.create.l HWIO_QDSS_AHB_DEC_NDPBAM_BAM_P_TIMER_CTRL0_ADDR A:0x60897020
y.create.l HWIO_QDSS_AHB_DEC_NDPBAM_BAM_P_TIMER_CTRL1_ADDR A:0x60898020
y.create.l HWIO_QDSS_AHB_DEC_NDPBAM_BAM_P_PRDCR_SDBND0_ADDR A:0x60897024
y.create.l HWIO_QDSS_AHB_DEC_NDPBAM_BAM_P_PRDCR_SDBND1_ADDR A:0x60898024
y.create.l HWIO_QDSS_AHB_DEC_NDPBAM_BAM_P_CNSMR_SDBND0_ADDR A:0x60897028
y.create.l HWIO_QDSS_AHB_DEC_NDPBAM_BAM_P_CNSMR_SDBND1_ADDR A:0x60898028
y.create.l HWIO_QDSS_AHB_DEC_NDPBAM_BAM_P_SW_OFSTS0_ADDR A:0x60897800
y.create.l HWIO_QDSS_AHB_DEC_NDPBAM_BAM_P_SW_OFSTS1_ADDR A:0x60898800
y.create.l HWIO_QDSS_AHB_DEC_NDPBAM_BAM_P_AU_PSM_CNTXT_1_0_ADDR A:0x60897804
y.create.l HWIO_QDSS_AHB_DEC_NDPBAM_BAM_P_AU_PSM_CNTXT_1_1_ADDR A:0x60898804
y.create.l HWIO_QDSS_AHB_DEC_NDPBAM_BAM_P_PSM_CNTXT_2_0_ADDR A:0x60897808
y.create.l HWIO_QDSS_AHB_DEC_NDPBAM_BAM_P_PSM_CNTXT_2_1_ADDR A:0x60898808
y.create.l HWIO_QDSS_AHB_DEC_NDPBAM_BAM_P_PSM_CNTXT_3_0_ADDR A:0x6089780c
y.create.l HWIO_QDSS_AHB_DEC_NDPBAM_BAM_P_PSM_CNTXT_3_1_ADDR A:0x6089880c
y.create.l HWIO_QDSS_AHB_DEC_NDPBAM_BAM_P_PSM_CNTXT_4_0_ADDR A:0x60897810
y.create.l HWIO_QDSS_AHB_DEC_NDPBAM_BAM_P_PSM_CNTXT_4_1_ADDR A:0x60898810
y.create.l HWIO_QDSS_AHB_DEC_NDPBAM_BAM_P_PSM_CNTXT_5_0_ADDR A:0x60897814
y.create.l HWIO_QDSS_AHB_DEC_NDPBAM_BAM_P_PSM_CNTXT_5_1_ADDR A:0x60898814
y.create.l HWIO_QDSS_AHB_DEC_NDPBAM_BAM_P_EVNT_REG0_ADDR A:0x60897818
y.create.l HWIO_QDSS_AHB_DEC_NDPBAM_BAM_P_EVNT_REG1_ADDR A:0x60898818
y.create.l HWIO_QDSS_AHB_DEC_NDPBAM_BAM_P_DESC_FIFO_ADDR0_ADDR A:0x6089781c
y.create.l HWIO_QDSS_AHB_DEC_NDPBAM_BAM_P_DESC_FIFO_ADDR1_ADDR A:0x6089881c
y.create.l HWIO_QDSS_AHB_DEC_NDPBAM_BAM_P_FIFO_SIZES0_ADDR A:0x60897820
y.create.l HWIO_QDSS_AHB_DEC_NDPBAM_BAM_P_FIFO_SIZES1_ADDR A:0x60898820
y.create.l HWIO_QDSS_AHB_DEC_NDPBAM_BAM_P_DATA_FIFO_ADDR0_ADDR A:0x60897824
y.create.l HWIO_QDSS_AHB_DEC_NDPBAM_BAM_P_DATA_FIFO_ADDR1_ADDR A:0x60898824
y.create.l HWIO_QDSS_AHB_DEC_NDPBAM_BAM_P_EVNT_GEN_TRSHLD0_ADDR A:0x60897828
y.create.l HWIO_QDSS_AHB_DEC_NDPBAM_BAM_P_EVNT_GEN_TRSHLD1_ADDR A:0x60898828
y.create.l HWIO_QDSS_AHB_DEC_NDPBAM_BAM_P_EVNT_DEST_ADDR0_ADDR A:0x6089782c
y.create.l HWIO_QDSS_AHB_DEC_NDPBAM_BAM_P_EVNT_DEST_ADDR1_ADDR A:0x6089882c
y.create.l HWIO_QDSS_AHB_DEC_NDPBAM_BAM_P_DF_CNTXT_0_ADDR A:0x60897830
y.create.l HWIO_QDSS_AHB_DEC_NDPBAM_BAM_P_DF_CNTXT_1_ADDR A:0x60898830
y.create.l HWIO_QDSS_AHB_DEC_NDPBAM_BAM_P_RETR_CNTXT_0_ADDR A:0x60897834
y.create.l HWIO_QDSS_AHB_DEC_NDPBAM_BAM_P_RETR_CNTXT_1_ADDR A:0x60898834
y.create.l HWIO_QDSS_AHB_DEC_NDPBAM_BAM_P_SI_CNTXT_0_ADDR A:0x60897838
y.create.l HWIO_QDSS_AHB_DEC_NDPBAM_BAM_P_SI_CNTXT_1_ADDR A:0x60898838
y.create.l HWIO_QDSS_AHB_DEC_NDPBAM_BAM_P_PSM_CNTXT_3_LSB0_ADDR A:0x60897900
y.create.l HWIO_QDSS_AHB_DEC_NDPBAM_BAM_P_PSM_CNTXT_3_LSB1_ADDR A:0x60898900
y.create.l HWIO_QDSS_AHB_DEC_NDPBAM_BAM_P_PSM_CNTXT_3_MSB0_ADDR A:0x60897904
y.create.l HWIO_QDSS_AHB_DEC_NDPBAM_BAM_P_PSM_CNTXT_3_MSB1_ADDR A:0x60898904
y.create.l HWIO_QDSS_AHB_DEC_NDPBAM_BAM_P_DESC_FIFO_ADDR_LSB0_ADDR A:0x60897910
y.create.l HWIO_QDSS_AHB_DEC_NDPBAM_BAM_P_DESC_FIFO_ADDR_LSB1_ADDR A:0x60898910
y.create.l HWIO_QDSS_AHB_DEC_NDPBAM_BAM_P_DESC_FIFO_ADDR_MSB0_ADDR A:0x60897914
y.create.l HWIO_QDSS_AHB_DEC_NDPBAM_BAM_P_DESC_FIFO_ADDR_MSB1_ADDR A:0x60898914
y.create.l HWIO_QDSS_AHB_DEC_NDPBAM_BAM_P_DATA_FIFO_ADDR_LSB0_ADDR A:0x60897920
y.create.l HWIO_QDSS_AHB_DEC_NDPBAM_BAM_P_DATA_FIFO_ADDR_LSB1_ADDR A:0x60898920
y.create.l HWIO_QDSS_AHB_DEC_NDPBAM_BAM_P_DATA_FIFO_ADDR_MSB0_ADDR A:0x60897924
y.create.l HWIO_QDSS_AHB_DEC_NDPBAM_BAM_P_DATA_FIFO_ADDR_MSB1_ADDR A:0x60898924
y.create.l HWIO_QDSS_AHB_DEC_NDPBAM_BAM_P_EVNT_DEST_ADDR_LSB0_ADDR A:0x60897930
y.create.l HWIO_QDSS_AHB_DEC_NDPBAM_BAM_P_EVNT_DEST_ADDR_LSB1_ADDR A:0x60898930
y.create.l HWIO_QDSS_AHB_DEC_NDPBAM_BAM_P_EVNT_DEST_ADDR_MSB0_ADDR A:0x60897934
y.create.l HWIO_QDSS_AHB_DEC_NDPBAM_BAM_P_EVNT_DEST_ADDR_MSB1_ADDR A:0x60898934
y.create.l HWIO_QDSS_APB_DEC_CORESIGHT_CSR_ROM_WORD_ADDR A:0x60800000
y.create.l HWIO_QDSS_APB_DEC_STM_ROM_WORD_ADDR A:0x60800004
y.create.l HWIO_QDSS_APB_DEC_CTI0_ROM_WORD_ADDR A:0x60800008
y.create.l HWIO_QDSS_APB_DEC_CTI1_ROM_WORD_ADDR A:0x6080000c
y.create.l HWIO_QDSS_APB_DEC_CTI2_ROM_WORD_ADDR A:0x60800010
y.create.l HWIO_QDSS_APB_DEC_CTI3_ROM_WORD_ADDR A:0x60800014
y.create.l HWIO_QDSS_APB_DEC_CTI4_ROM_WORD_ADDR A:0x60800018
y.create.l HWIO_QDSS_APB_DEC_CTI5_ROM_WORD_ADDR A:0x6080001c
y.create.l HWIO_QDSS_APB_DEC_CTI6_ROM_WORD_ADDR A:0x60800020
y.create.l HWIO_QDSS_APB_DEC_CTI7_ROM_WORD_ADDR A:0x60800024
y.create.l HWIO_QDSS_APB_DEC_CTI8_ROM_WORD_ADDR A:0x60800028
y.create.l HWIO_QDSS_APB_DEC_TPIU_ROM_WORD_ADDR A:0x6080002c
y.create.l HWIO_QDSS_APB_DEC_TFUN0_ROM_WORD_ADDR A:0x60800030
y.create.l HWIO_QDSS_APB_DEC_TREPL_ROM_WORD_ADDR A:0x60800034
y.create.l HWIO_QDSS_APB_DEC_ETBETF_ROM_WORD_ADDR A:0x60800038
y.create.l HWIO_QDSS_APB_DEC_ETR_ROM_WORD_ADDR A:0x6080003c
y.create.l HWIO_QDSS_APB_DEC_MSS_Q6_CTI_ROM_WORD_ADDR A:0x60800040
y.create.l HWIO_QDSS_APB_DEC_RPM_CM3_CTI_ROM_WORD_ADDR A:0x60800044
y.create.l HWIO_QDSS_APB_DEC_A7_DBG_ROM_WORD_ADDR A:0x60800048
y.create.l HWIO_QDSS_APB_DEC_A7_PM_ROM_WORD_ADDR A:0x6080004c
y.create.l HWIO_QDSS_APB_DEC_A7_TRACE_ROM_WORD_ADDR A:0x60800050
y.create.l HWIO_QDSS_APB_DEC_A7_CTI_ROM_WORD_ADDR A:0x60800054
y.create.l HWIO_QDSS_APB_DEC_QDSS_WRAPPER_2X1_FUNNEL_ROM_WORD_ADDR A:0x60800058
y.create.l HWIO_QDSS_APB_DEC_HWE_EXPD_MUX_CFG_ROM_WORD_ADDR A:0x6080005c
y.create.l HWIO_QDSS_APB_DEC_DBGUI_CFG_ROM_WORD_ADDR A:0x60800060
y.create.l HWIO_QDSS_APB_DEC_DAPROM_PERIPHERAL_ID4_ADDR A:0x60800fd0
y.create.l HWIO_QDSS_APB_DEC_DAPROM_PERIPHERAL_ID5_ADDR A:0x60800fd4
y.create.l HWIO_QDSS_APB_DEC_DAPROM_PERIPHERAL_ID6_ADDR A:0x60800fd8
y.create.l HWIO_QDSS_APB_DEC_DAPROM_PERIPHERAL_ID7_ADDR A:0x60800fdc
y.create.l HWIO_QDSS_APB_DEC_DAPROM_PERIPHERAL_ID0_ADDR A:0x60800fe0
y.create.l HWIO_QDSS_APB_DEC_DAPROM_PERIPHERAL_ID1_ADDR A:0x60800fe4
y.create.l HWIO_QDSS_APB_DEC_DAPROM_PERIPHERAL_ID2_ADDR A:0x60800fe8
y.create.l HWIO_QDSS_APB_DEC_DAPROM_PERIPHERAL_ID3_ADDR A:0x60800fec
y.create.l HWIO_QDSS_APB_DEC_DAPROM_COMPONENT_ID0_ADDR A:0x60800ff0
y.create.l HWIO_QDSS_APB_DEC_DAPROM_COMPONENT_ID1_ADDR A:0x60800ff4
y.create.l HWIO_QDSS_APB_DEC_DAPROM_COMPONENT_ID2_ADDR A:0x60800ff8
y.create.l HWIO_QDSS_APB_DEC_DAPROM_COMPONENT_ID3_ADDR A:0x60800ffc
y.create.l HWIO_QDSS_APB_DEC_CS_QDSSCSR_SWDBGPWRCTRL_ADDR A:0x60801000
y.create.l HWIO_QDSS_APB_DEC_CS_QDSSCSR_SWDBGPWRACK_ADDR A:0x60801004
y.create.l HWIO_QDSS_APB_DEC_CS_QDSSCSR_SWSPADREG0_ADDR A:0x60801008
y.create.l HWIO_QDSS_APB_DEC_CS_QDSSCSR_SWSPADREG1_ADDR A:0x6080100c
y.create.l HWIO_QDSS_APB_DEC_CS_QDSSCSR_STMTRANSCTRL_ADDR A:0x60801010
y.create.l HWIO_QDSS_APB_DEC_CS_QDSSCSR_STMAWIDCTRL_ADDR A:0x60801014
y.create.l HWIO_QDSS_APB_DEC_CS_QDSSCSR_STMCHNOFST0_ADDR A:0x60801018
y.create.l HWIO_QDSS_APB_DEC_CS_QDSSCSR_STMCHNOFST1_ADDR A:0x6080101c
y.create.l HWIO_QDSS_APB_DEC_CS_QDSSCSR_STMEXTHWCTRL0_ADDR A:0x60801020
y.create.l HWIO_QDSS_APB_DEC_CS_QDSSCSR_STMEXTHWCTRL1_ADDR A:0x60801024
y.create.l HWIO_QDSS_APB_DEC_CS_QDSSCSR_STMEXTHWCTRL2_ADDR A:0x60801028
y.create.l HWIO_QDSS_APB_DEC_CS_QDSSCSR_STMEXTHWCTRL3_ADDR A:0x6080102c
y.create.l HWIO_QDSS_APB_DEC_CS_QDSSCSR_USBBAMCTRL_ADDR A:0x60801030
y.create.l HWIO_QDSS_APB_DEC_CS_QDSSCSR_USBFLSHCTRL_ADDR A:0x60801034
y.create.l HWIO_QDSS_APB_DEC_CS_QDSSCSR_TIMESTAMPCTRL_ADDR A:0x60801038
y.create.l HWIO_QDSS_APB_DEC_CS_QDSSCSR_AOTIMEVAL0_ADDR A:0x6080103c
y.create.l HWIO_QDSS_APB_DEC_CS_QDSSCSR_AOTIMEVAL1_ADDR A:0x60801040
y.create.l HWIO_QDSS_APB_DEC_CS_QDSSCSR_QDSSTIMEVAL0_ADDR A:0x60801044
y.create.l HWIO_QDSS_APB_DEC_CS_QDSSCSR_QDSSTIMEVAL1_ADDR A:0x60801048
y.create.l HWIO_QDSS_APB_DEC_CS_QDSSCSR_QDSSTIMELOAD0_ADDR A:0x6080104c
y.create.l HWIO_QDSS_APB_DEC_CS_QDSSCSR_QDSSTIMELOAD1_ADDR A:0x60801050
y.create.l HWIO_QDSS_APB_DEC_CS_QDSSCSR_DAPMSAVAL_ADDR A:0x60801054
y.create.l HWIO_QDSS_APB_DEC_CS_QDSSCSR_QDSSCLKVOTE_ADDR A:0x60801058
y.create.l HWIO_QDSS_APB_DEC_CS_QDSSCSR_QDSSCLKIPI_ADDR A:0x6080105c
y.create.l HWIO_QDSS_APB_DEC_CS_QDSSCSR_QDSSPWRREQIGNORE_ADDR A:0x60801060
y.create.l HWIO_QDSS_APB_DEC_CS_QDSSCSR_QDSSSPARE_ADDR A:0x60801064
y.create.l HWIO_QDSS_APB_DEC_CS_QDSSCSR_IPCAT_ADDR A:0x60801068
y.create.l HWIO_QDSS_APB_DEC_CS_QDSSCSR_ETRIRQCTRL_ADDR A:0x6080106c
y.create.l HWIO_QDSS_APB_DEC_CS_QDSSCSR_PRESERVEETF_ADDR A:0x60801070
y.create.l HWIO_QDSS_APB_DEC_CS_QDSSCSR_PRESERVEETR0_ADDR A:0x60801074
y.create.l HWIO_QDSS_APB_DEC_CS_QDSSCSR_PRESERVEETR1_ADDR A:0x60801078
y.create.l HWIO_QDSS_APB_DEC_CS_QDSSCSR_ITCTL_ADDR A:0x60801f00
y.create.l HWIO_QDSS_APB_DEC_CS_QDSSCSR_CLAIMSET_ADDR A:0x60801fa0
y.create.l HWIO_QDSS_APB_DEC_CS_QDSSCSR_CLAIMCLR_ADDR A:0x60801fa4
y.create.l HWIO_QDSS_APB_DEC_CS_QDSSCSR_LOCKACCESS_ADDR A:0x60801fb0
y.create.l HWIO_QDSS_APB_DEC_CS_QDSSCSR_LOCKSTATUS_ADDR A:0x60801fb4
y.create.l HWIO_QDSS_APB_DEC_CS_QDSSCSR_AUTHSTATUS_ADDR A:0x60801fb8
y.create.l HWIO_QDSS_APB_DEC_CS_QDSSCSR_DEVICEID_ADDR A:0x60801fc8
y.create.l HWIO_QDSS_APB_DEC_CS_QDSSCSR_DEVICETYPE_ADDR A:0x60801fcc
y.create.l HWIO_QDSS_APB_DEC_CS_QDSSCSR_PERIPHID4_ADDR A:0x60801fd0
y.create.l HWIO_QDSS_APB_DEC_CS_QDSSCSR_PERIPHID5_ADDR A:0x60801fd4
y.create.l HWIO_QDSS_APB_DEC_CS_QDSSCSR_PERIPHID6_ADDR A:0x60801fd8
y.create.l HWIO_QDSS_APB_DEC_CS_QDSSCSR_PERIPHID7_ADDR A:0x60801fdc
y.create.l HWIO_QDSS_APB_DEC_CS_QDSSCSR_PERIPHID0_ADDR A:0x60801fe0
y.create.l HWIO_QDSS_APB_DEC_CS_QDSSCSR_PERIPHID1_ADDR A:0x60801fe4
y.create.l HWIO_QDSS_APB_DEC_CS_QDSSCSR_PERIPHID2_ADDR A:0x60801fe8
y.create.l HWIO_QDSS_APB_DEC_CS_QDSSCSR_PERIPHID3_ADDR A:0x60801fec
y.create.l HWIO_QDSS_APB_DEC_CS_QDSSCSR_COMPID0_ADDR A:0x60801ff0
y.create.l HWIO_QDSS_APB_DEC_CS_QDSSCSR_COMPID1_ADDR A:0x60801ff4
y.create.l HWIO_QDSS_APB_DEC_CS_QDSSCSR_COMPID2_ADDR A:0x60801ff8
y.create.l HWIO_QDSS_APB_DEC_CS_QDSSCSR_COMPID3_ADDR A:0x60801ffc
y.create.l HWIO_QDSS_APB_DEC_STMDMASTARTR_ADDR A:0x60802c04
y.create.l HWIO_QDSS_APB_DEC_STMDMASTOPR_ADDR A:0x60802c08
y.create.l HWIO_QDSS_APB_DEC_STMDMASTATR_ADDR A:0x60802c0c
y.create.l HWIO_QDSS_APB_DEC_STMDMACTLR_ADDR A:0x60802c10
y.create.l HWIO_QDSS_APB_DEC_STMDMAIDR_ADDR A:0x60802cfc
y.create.l HWIO_QDSS_APB_DEC_STMHEER_ADDR A:0x60802d00
y.create.l HWIO_QDSS_APB_DEC_STMHETER_ADDR A:0x60802d20
y.create.l HWIO_QDSS_APB_DEC_STMHEMCR_ADDR A:0x60802d64
y.create.l HWIO_QDSS_APB_DEC_STMHEMASTR_ADDR A:0x60802df4
y.create.l HWIO_QDSS_APB_DEC_STMHEFEAT1R_ADDR A:0x60802df8
y.create.l HWIO_QDSS_APB_DEC_STMHEIDR_ADDR A:0x60802dfc
y.create.l HWIO_QDSS_APB_DEC_STMSPER_ADDR A:0x60802e00
y.create.l HWIO_QDSS_APB_DEC_STMSPTER_ADDR A:0x60802e20
y.create.l HWIO_QDSS_APB_DEC_STMSPSCR_ADDR A:0x60802e60
y.create.l HWIO_QDSS_APB_DEC_STMSPMSCR_ADDR A:0x60802e64
y.create.l HWIO_QDSS_APB_DEC_STMSPOVERRIDER_ADDR A:0x60802e68
y.create.l HWIO_QDSS_APB_DEC_STMSPMOVERRIDER_ADDR A:0x60802e6c
y.create.l HWIO_QDSS_APB_DEC_STMSPTRIGCSR_ADDR A:0x60802e70
y.create.l HWIO_QDSS_APB_DEC_STMTCSR_ADDR A:0x60802e80
y.create.l HWIO_QDSS_APB_DEC_STMTSSTIMR_ADDR A:0x60802e84
y.create.l HWIO_QDSS_APB_DEC_STMTSFREQR_ADDR A:0x60802e8c
y.create.l HWIO_QDSS_APB_DEC_STMSYNCR_ADDR A:0x60802e90
y.create.l HWIO_QDSS_APB_DEC_STMAUXCR_ADDR A:0x60802e94
y.create.l HWIO_QDSS_APB_DEC_STMSPFEAT1R_ADDR A:0x60802ea0
y.create.l HWIO_QDSS_APB_DEC_STMSPFEAT2R_ADDR A:0x60802ea4
y.create.l HWIO_QDSS_APB_DEC_STMSPFEAT3R_ADDR A:0x60802ea8
y.create.l HWIO_QDSS_APB_DEC_STMITTRIGGER_ADDR A:0x60802ee8
y.create.l HWIO_QDSS_APB_DEC_STMITATBDATA0_ADDR A:0x60802eec
y.create.l HWIO_QDSS_APB_DEC_STMITATBCTR2_ADDR A:0x60802ef0
y.create.l HWIO_QDSS_APB_DEC_STMITATBID_ADDR A:0x60802ef4
y.create.l HWIO_QDSS_APB_DEC_STMITATBCTR0_ADDR A:0x60802ef8
y.create.l HWIO_QDSS_APB_DEC_STMITCTRL_ADDR A:0x60802f00
y.create.l HWIO_QDSS_APB_DEC_STMCLAIMSET_ADDR A:0x60802fa0
y.create.l HWIO_QDSS_APB_DEC_STMCLAIMCLR_ADDR A:0x60802fa4
y.create.l HWIO_QDSS_APB_DEC_STMLAR_ADDR A:0x60802fb0
y.create.l HWIO_QDSS_APB_DEC_STMLSR_ADDR A:0x60802fb4
y.create.l HWIO_QDSS_APB_DEC_STMAUTHSTATUS_ADDR A:0x60802fb8
y.create.l HWIO_QDSS_APB_DEC_STMDEVID_ADDR A:0x60802fc8
y.create.l HWIO_QDSS_APB_DEC_STMDEVTYPE_ADDR A:0x60802fcc
y.create.l HWIO_QDSS_APB_DEC_STMPIDR0_ADDR A:0x60802fe0
y.create.l HWIO_QDSS_APB_DEC_STMPIDR1_ADDR A:0x60802fe4
y.create.l HWIO_QDSS_APB_DEC_STMPIDR2_ADDR A:0x60802fe8
y.create.l HWIO_QDSS_APB_DEC_STMPIDR3_ADDR A:0x60802fec
y.create.l HWIO_QDSS_APB_DEC_STMPIDR4_ADDR A:0x60802fd0
y.create.l HWIO_QDSS_APB_DEC_STMPIDR5_ADDR A:0x60802fd4
y.create.l HWIO_QDSS_APB_DEC_STMPIDR6_ADDR A:0x60802fd8
y.create.l HWIO_QDSS_APB_DEC_STMPIDR7_ADDR A:0x60802fdc
y.create.l HWIO_QDSS_APB_DEC_STMCIDR0_ADDR A:0x60802ff0
y.create.l HWIO_QDSS_APB_DEC_STMCIDR1_ADDR A:0x60802ff4
y.create.l HWIO_QDSS_APB_DEC_STMCIDR2_ADDR A:0x60802ff8
y.create.l HWIO_QDSS_APB_DEC_STMCIDR3_ADDR A:0x60802ffc
y.create.l HWIO_QDSS_APB_DEC_CTI0_CTICONTROL_ADDR A:0x60810000
y.create.l HWIO_QDSS_APB_DEC_CTI0_CTIINTACK_ADDR A:0x60810010
y.create.l HWIO_QDSS_APB_DEC_CTI0_CTIAPPSET_ADDR A:0x60810014
y.create.l HWIO_QDSS_APB_DEC_CTI0_CTIAPPCLEAR_ADDR A:0x60810018
y.create.l HWIO_QDSS_APB_DEC_CTI0_CTIAPPPULSE_ADDR A:0x6081001c
y.create.l HWIO_QDSS_APB_DEC_CTI0_CTIINEN0_ADDR A:0x60810020
y.create.l HWIO_QDSS_APB_DEC_CTI0_CTIINEN1_ADDR A:0x60810024
y.create.l HWIO_QDSS_APB_DEC_CTI0_CTIINEN2_ADDR A:0x60810028
y.create.l HWIO_QDSS_APB_DEC_CTI0_CTIINEN3_ADDR A:0x6081002c
y.create.l HWIO_QDSS_APB_DEC_CTI0_CTIINEN4_ADDR A:0x60810030
y.create.l HWIO_QDSS_APB_DEC_CTI0_CTIINEN5_ADDR A:0x60810034
y.create.l HWIO_QDSS_APB_DEC_CTI0_CTIINEN6_ADDR A:0x60810038
y.create.l HWIO_QDSS_APB_DEC_CTI0_CTIINEN7_ADDR A:0x6081003c
y.create.l HWIO_QDSS_APB_DEC_CTI0_CTIOUTEN0_ADDR A:0x608100a0
y.create.l HWIO_QDSS_APB_DEC_CTI0_CTIOUTEN1_ADDR A:0x608100a4
y.create.l HWIO_QDSS_APB_DEC_CTI0_CTIOUTEN2_ADDR A:0x608100a8
y.create.l HWIO_QDSS_APB_DEC_CTI0_CTIOUTEN3_ADDR A:0x608100ac
y.create.l HWIO_QDSS_APB_DEC_CTI0_CTIOUTEN4_ADDR A:0x608100b0
y.create.l HWIO_QDSS_APB_DEC_CTI0_CTIOUTEN5_ADDR A:0x608100b4
y.create.l HWIO_QDSS_APB_DEC_CTI0_CTIOUTEN6_ADDR A:0x608100b8
y.create.l HWIO_QDSS_APB_DEC_CTI0_CTIOUTEN7_ADDR A:0x608100bc
y.create.l HWIO_QDSS_APB_DEC_CTI0_CTITRIGINSTATUS_ADDR A:0x60810130
y.create.l HWIO_QDSS_APB_DEC_CTI0_CTITRIGOUTSTATUS_ADDR A:0x60810134
y.create.l HWIO_QDSS_APB_DEC_CTI0_CTICHINSTATUS_ADDR A:0x60810138
y.create.l HWIO_QDSS_APB_DEC_CTI0_CTICHOUTSTATUS_ADDR A:0x6081013c
y.create.l HWIO_QDSS_APB_DEC_CTI0_CTIGATE_ADDR A:0x60810140
y.create.l HWIO_QDSS_APB_DEC_CTI0_ASICCTL_ADDR A:0x60810144
y.create.l HWIO_QDSS_APB_DEC_CTI0_ITCHINACK_ADDR A:0x60810edc
y.create.l HWIO_QDSS_APB_DEC_CTI0_ITTRIGINACK_ADDR A:0x60810ee0
y.create.l HWIO_QDSS_APB_DEC_CTI0_ITCHOUT_ADDR A:0x60810ee4
y.create.l HWIO_QDSS_APB_DEC_CTI0_ITTRIGOUT_ADDR A:0x60810ee8
y.create.l HWIO_QDSS_APB_DEC_CTI0_ITCHOUTACK_ADDR A:0x60810eec
y.create.l HWIO_QDSS_APB_DEC_CTI0_ITTRIGOUTACK_ADDR A:0x60810ef0
y.create.l HWIO_QDSS_APB_DEC_CTI0_ITCHIN_ADDR A:0x60810ef4
y.create.l HWIO_QDSS_APB_DEC_CTI0_ITTRIGIN_ADDR A:0x60810ef8
y.create.l HWIO_QDSS_APB_DEC_CTI0_ITCTRL_ADDR A:0x60810f00
y.create.l HWIO_QDSS_APB_DEC_CTI0_CLAIMSET_ADDR A:0x60810fa0
y.create.l HWIO_QDSS_APB_DEC_CTI0_CLAIMCLR_ADDR A:0x60810fa4
y.create.l HWIO_QDSS_APB_DEC_CTI0_LAR_ADDR A:0x60810fb0
y.create.l HWIO_QDSS_APB_DEC_CTI0_LSR_ADDR A:0x60810fb4
y.create.l HWIO_QDSS_APB_DEC_CTI0_AUTHSTATUS_ADDR A:0x60810fb8
y.create.l HWIO_QDSS_APB_DEC_CTI0_DEVID_ADDR A:0x60810fc8
y.create.l HWIO_QDSS_APB_DEC_CTI0_DEVTYPE_ADDR A:0x60810fcc
y.create.l HWIO_QDSS_APB_DEC_CTI0_PERIPHID0_ADDR A:0x60810fe0
y.create.l HWIO_QDSS_APB_DEC_CTI0_PERIPHID1_ADDR A:0x60810fe4
y.create.l HWIO_QDSS_APB_DEC_CTI0_PERIPHID2_ADDR A:0x60810fe8
y.create.l HWIO_QDSS_APB_DEC_CTI0_PERIPHID3_ADDR A:0x60810fec
y.create.l HWIO_QDSS_APB_DEC_CTI0_PERIPHID4_ADDR A:0x60810fd0
y.create.l HWIO_QDSS_APB_DEC_CTI0_PERIPHID5_ADDR A:0x60810fd4
y.create.l HWIO_QDSS_APB_DEC_CTI0_PERIPHID6_ADDR A:0x60810fd8
y.create.l HWIO_QDSS_APB_DEC_CTI0_PERIPHID7_ADDR A:0x60810fdc
y.create.l HWIO_QDSS_APB_DEC_CTI0_COMPID0_ADDR A:0x60810ff0
y.create.l HWIO_QDSS_APB_DEC_CTI0_COMPID1_ADDR A:0x60810ff4
y.create.l HWIO_QDSS_APB_DEC_CTI0_COMPID2_ADDR A:0x60810ff8
y.create.l HWIO_QDSS_APB_DEC_CTI0_COMPID3_ADDR A:0x60810ffc
y.create.l HWIO_QDSS_APB_DEC_CTI1_CTICONTROL_ADDR A:0x60811000
y.create.l HWIO_QDSS_APB_DEC_CTI1_CTIINTACK_ADDR A:0x60811010
y.create.l HWIO_QDSS_APB_DEC_CTI1_CTIAPPSET_ADDR A:0x60811014
y.create.l HWIO_QDSS_APB_DEC_CTI1_CTIAPPCLEAR_ADDR A:0x60811018
y.create.l HWIO_QDSS_APB_DEC_CTI1_CTIAPPPULSE_ADDR A:0x6081101c
y.create.l HWIO_QDSS_APB_DEC_CTI1_CTIINEN0_ADDR A:0x60811020
y.create.l HWIO_QDSS_APB_DEC_CTI1_CTIINEN1_ADDR A:0x60811024
y.create.l HWIO_QDSS_APB_DEC_CTI1_CTIINEN2_ADDR A:0x60811028
y.create.l HWIO_QDSS_APB_DEC_CTI1_CTIINEN3_ADDR A:0x6081102c
y.create.l HWIO_QDSS_APB_DEC_CTI1_CTIINEN4_ADDR A:0x60811030
y.create.l HWIO_QDSS_APB_DEC_CTI1_CTIINEN5_ADDR A:0x60811034
y.create.l HWIO_QDSS_APB_DEC_CTI1_CTIINEN6_ADDR A:0x60811038
y.create.l HWIO_QDSS_APB_DEC_CTI1_CTIINEN7_ADDR A:0x6081103c
y.create.l HWIO_QDSS_APB_DEC_CTI1_CTIOUTEN0_ADDR A:0x608110a0
y.create.l HWIO_QDSS_APB_DEC_CTI1_CTIOUTEN1_ADDR A:0x608110a4
y.create.l HWIO_QDSS_APB_DEC_CTI1_CTIOUTEN2_ADDR A:0x608110a8
y.create.l HWIO_QDSS_APB_DEC_CTI1_CTIOUTEN3_ADDR A:0x608110ac
y.create.l HWIO_QDSS_APB_DEC_CTI1_CTIOUTEN4_ADDR A:0x608110b0
y.create.l HWIO_QDSS_APB_DEC_CTI1_CTIOUTEN5_ADDR A:0x608110b4
y.create.l HWIO_QDSS_APB_DEC_CTI1_CTIOUTEN6_ADDR A:0x608110b8
y.create.l HWIO_QDSS_APB_DEC_CTI1_CTIOUTEN7_ADDR A:0x608110bc
y.create.l HWIO_QDSS_APB_DEC_CTI1_CTITRIGINSTATUS_ADDR A:0x60811130
y.create.l HWIO_QDSS_APB_DEC_CTI1_CTITRIGOUTSTATUS_ADDR A:0x60811134
y.create.l HWIO_QDSS_APB_DEC_CTI1_CTICHINSTATUS_ADDR A:0x60811138
y.create.l HWIO_QDSS_APB_DEC_CTI1_CTICHOUTSTATUS_ADDR A:0x6081113c
y.create.l HWIO_QDSS_APB_DEC_CTI1_CTIGATE_ADDR A:0x60811140
y.create.l HWIO_QDSS_APB_DEC_CTI1_ASICCTL_ADDR A:0x60811144
y.create.l HWIO_QDSS_APB_DEC_CTI1_ITCHINACK_ADDR A:0x60811edc
y.create.l HWIO_QDSS_APB_DEC_CTI1_ITTRIGINACK_ADDR A:0x60811ee0
y.create.l HWIO_QDSS_APB_DEC_CTI1_ITCHOUT_ADDR A:0x60811ee4
y.create.l HWIO_QDSS_APB_DEC_CTI1_ITTRIGOUT_ADDR A:0x60811ee8
y.create.l HWIO_QDSS_APB_DEC_CTI1_ITCHOUTACK_ADDR A:0x60811eec
y.create.l HWIO_QDSS_APB_DEC_CTI1_ITTRIGOUTACK_ADDR A:0x60811ef0
y.create.l HWIO_QDSS_APB_DEC_CTI1_ITCHIN_ADDR A:0x60811ef4
y.create.l HWIO_QDSS_APB_DEC_CTI1_ITTRIGIN_ADDR A:0x60811ef8
y.create.l HWIO_QDSS_APB_DEC_CTI1_ITCTRL_ADDR A:0x60811f00
y.create.l HWIO_QDSS_APB_DEC_CTI1_CLAIMSET_ADDR A:0x60811fa0
y.create.l HWIO_QDSS_APB_DEC_CTI1_CLAIMCLR_ADDR A:0x60811fa4
y.create.l HWIO_QDSS_APB_DEC_CTI1_LAR_ADDR A:0x60811fb0
y.create.l HWIO_QDSS_APB_DEC_CTI1_LSR_ADDR A:0x60811fb4
y.create.l HWIO_QDSS_APB_DEC_CTI1_AUTHSTATUS_ADDR A:0x60811fb8
y.create.l HWIO_QDSS_APB_DEC_CTI1_DEVID_ADDR A:0x60811fc8
y.create.l HWIO_QDSS_APB_DEC_CTI1_DEVTYPE_ADDR A:0x60811fcc
y.create.l HWIO_QDSS_APB_DEC_CTI1_PERIPHID0_ADDR A:0x60811fe0
y.create.l HWIO_QDSS_APB_DEC_CTI1_PERIPHID1_ADDR A:0x60811fe4
y.create.l HWIO_QDSS_APB_DEC_CTI1_PERIPHID2_ADDR A:0x60811fe8
y.create.l HWIO_QDSS_APB_DEC_CTI1_PERIPHID3_ADDR A:0x60811fec
y.create.l HWIO_QDSS_APB_DEC_CTI1_PERIPHID4_ADDR A:0x60811fd0
y.create.l HWIO_QDSS_APB_DEC_CTI1_PERIPHID5_ADDR A:0x60811fd4
y.create.l HWIO_QDSS_APB_DEC_CTI1_PERIPHID6_ADDR A:0x60811fd8
y.create.l HWIO_QDSS_APB_DEC_CTI1_PERIPHID7_ADDR A:0x60811fdc
y.create.l HWIO_QDSS_APB_DEC_CTI1_COMPID0_ADDR A:0x60811ff0
y.create.l HWIO_QDSS_APB_DEC_CTI1_COMPID1_ADDR A:0x60811ff4
y.create.l HWIO_QDSS_APB_DEC_CTI1_COMPID2_ADDR A:0x60811ff8
y.create.l HWIO_QDSS_APB_DEC_CTI1_COMPID3_ADDR A:0x60811ffc
y.create.l HWIO_QDSS_APB_DEC_CTI2_CTICONTROL_ADDR A:0x60812000
y.create.l HWIO_QDSS_APB_DEC_CTI2_CTIINTACK_ADDR A:0x60812010
y.create.l HWIO_QDSS_APB_DEC_CTI2_CTIAPPSET_ADDR A:0x60812014
y.create.l HWIO_QDSS_APB_DEC_CTI2_CTIAPPCLEAR_ADDR A:0x60812018
y.create.l HWIO_QDSS_APB_DEC_CTI2_CTIAPPPULSE_ADDR A:0x6081201c
y.create.l HWIO_QDSS_APB_DEC_CTI2_CTIINEN0_ADDR A:0x60812020
y.create.l HWIO_QDSS_APB_DEC_CTI2_CTIINEN1_ADDR A:0x60812024
y.create.l HWIO_QDSS_APB_DEC_CTI2_CTIINEN2_ADDR A:0x60812028
y.create.l HWIO_QDSS_APB_DEC_CTI2_CTIINEN3_ADDR A:0x6081202c
y.create.l HWIO_QDSS_APB_DEC_CTI2_CTIINEN4_ADDR A:0x60812030
y.create.l HWIO_QDSS_APB_DEC_CTI2_CTIINEN5_ADDR A:0x60812034
y.create.l HWIO_QDSS_APB_DEC_CTI2_CTIINEN6_ADDR A:0x60812038
y.create.l HWIO_QDSS_APB_DEC_CTI2_CTIINEN7_ADDR A:0x6081203c
y.create.l HWIO_QDSS_APB_DEC_CTI2_CTIOUTEN0_ADDR A:0x608120a0
y.create.l HWIO_QDSS_APB_DEC_CTI2_CTIOUTEN1_ADDR A:0x608120a4
y.create.l HWIO_QDSS_APB_DEC_CTI2_CTIOUTEN2_ADDR A:0x608120a8
y.create.l HWIO_QDSS_APB_DEC_CTI2_CTIOUTEN3_ADDR A:0x608120ac
y.create.l HWIO_QDSS_APB_DEC_CTI2_CTIOUTEN4_ADDR A:0x608120b0
y.create.l HWIO_QDSS_APB_DEC_CTI2_CTIOUTEN5_ADDR A:0x608120b4
y.create.l HWIO_QDSS_APB_DEC_CTI2_CTIOUTEN6_ADDR A:0x608120b8
y.create.l HWIO_QDSS_APB_DEC_CTI2_CTIOUTEN7_ADDR A:0x608120bc
y.create.l HWIO_QDSS_APB_DEC_CTI2_CTITRIGINSTATUS_ADDR A:0x60812130
y.create.l HWIO_QDSS_APB_DEC_CTI2_CTITRIGOUTSTATUS_ADDR A:0x60812134
y.create.l HWIO_QDSS_APB_DEC_CTI2_CTICHINSTATUS_ADDR A:0x60812138
y.create.l HWIO_QDSS_APB_DEC_CTI2_CTICHOUTSTATUS_ADDR A:0x6081213c
y.create.l HWIO_QDSS_APB_DEC_CTI2_CTIGATE_ADDR A:0x60812140
y.create.l HWIO_QDSS_APB_DEC_CTI2_ASICCTL_ADDR A:0x60812144
y.create.l HWIO_QDSS_APB_DEC_CTI2_ITCHINACK_ADDR A:0x60812edc
y.create.l HWIO_QDSS_APB_DEC_CTI2_ITTRIGINACK_ADDR A:0x60812ee0
y.create.l HWIO_QDSS_APB_DEC_CTI2_ITCHOUT_ADDR A:0x60812ee4
y.create.l HWIO_QDSS_APB_DEC_CTI2_ITTRIGOUT_ADDR A:0x60812ee8
y.create.l HWIO_QDSS_APB_DEC_CTI2_ITCHOUTACK_ADDR A:0x60812eec
y.create.l HWIO_QDSS_APB_DEC_CTI2_ITTRIGOUTACK_ADDR A:0x60812ef0
y.create.l HWIO_QDSS_APB_DEC_CTI2_ITCHIN_ADDR A:0x60812ef4
y.create.l HWIO_QDSS_APB_DEC_CTI2_ITTRIGIN_ADDR A:0x60812ef8
y.create.l HWIO_QDSS_APB_DEC_CTI2_ITCTRL_ADDR A:0x60812f00
y.create.l HWIO_QDSS_APB_DEC_CTI2_CLAIMSET_ADDR A:0x60812fa0
y.create.l HWIO_QDSS_APB_DEC_CTI2_CLAIMCLR_ADDR A:0x60812fa4
y.create.l HWIO_QDSS_APB_DEC_CTI2_LAR_ADDR A:0x60812fb0
y.create.l HWIO_QDSS_APB_DEC_CTI2_LSR_ADDR A:0x60812fb4
y.create.l HWIO_QDSS_APB_DEC_CTI2_AUTHSTATUS_ADDR A:0x60812fb8
y.create.l HWIO_QDSS_APB_DEC_CTI2_DEVID_ADDR A:0x60812fc8
y.create.l HWIO_QDSS_APB_DEC_CTI2_DEVTYPE_ADDR A:0x60812fcc
y.create.l HWIO_QDSS_APB_DEC_CTI2_PERIPHID0_ADDR A:0x60812fe0
y.create.l HWIO_QDSS_APB_DEC_CTI2_PERIPHID1_ADDR A:0x60812fe4
y.create.l HWIO_QDSS_APB_DEC_CTI2_PERIPHID2_ADDR A:0x60812fe8
y.create.l HWIO_QDSS_APB_DEC_CTI2_PERIPHID3_ADDR A:0x60812fec
y.create.l HWIO_QDSS_APB_DEC_CTI2_PERIPHID4_ADDR A:0x60812fd0
y.create.l HWIO_QDSS_APB_DEC_CTI2_PERIPHID5_ADDR A:0x60812fd4
y.create.l HWIO_QDSS_APB_DEC_CTI2_PERIPHID6_ADDR A:0x60812fd8
y.create.l HWIO_QDSS_APB_DEC_CTI2_PERIPHID7_ADDR A:0x60812fdc
y.create.l HWIO_QDSS_APB_DEC_CTI2_COMPID0_ADDR A:0x60812ff0
y.create.l HWIO_QDSS_APB_DEC_CTI2_COMPID1_ADDR A:0x60812ff4
y.create.l HWIO_QDSS_APB_DEC_CTI2_COMPID2_ADDR A:0x60812ff8
y.create.l HWIO_QDSS_APB_DEC_CTI2_COMPID3_ADDR A:0x60812ffc
y.create.l HWIO_QDSS_APB_DEC_CTI3_CTICONTROL_ADDR A:0x60813000
y.create.l HWIO_QDSS_APB_DEC_CTI3_CTIINTACK_ADDR A:0x60813010
y.create.l HWIO_QDSS_APB_DEC_CTI3_CTIAPPSET_ADDR A:0x60813014
y.create.l HWIO_QDSS_APB_DEC_CTI3_CTIAPPCLEAR_ADDR A:0x60813018
y.create.l HWIO_QDSS_APB_DEC_CTI3_CTIAPPPULSE_ADDR A:0x6081301c
y.create.l HWIO_QDSS_APB_DEC_CTI3_CTIINEN0_ADDR A:0x60813020
y.create.l HWIO_QDSS_APB_DEC_CTI3_CTIINEN1_ADDR A:0x60813024
y.create.l HWIO_QDSS_APB_DEC_CTI3_CTIINEN2_ADDR A:0x60813028
y.create.l HWIO_QDSS_APB_DEC_CTI3_CTIINEN3_ADDR A:0x6081302c
y.create.l HWIO_QDSS_APB_DEC_CTI3_CTIINEN4_ADDR A:0x60813030
y.create.l HWIO_QDSS_APB_DEC_CTI3_CTIINEN5_ADDR A:0x60813034
y.create.l HWIO_QDSS_APB_DEC_CTI3_CTIINEN6_ADDR A:0x60813038
y.create.l HWIO_QDSS_APB_DEC_CTI3_CTIINEN7_ADDR A:0x6081303c
y.create.l HWIO_QDSS_APB_DEC_CTI3_CTIOUTEN0_ADDR A:0x608130a0
y.create.l HWIO_QDSS_APB_DEC_CTI3_CTIOUTEN1_ADDR A:0x608130a4
y.create.l HWIO_QDSS_APB_DEC_CTI3_CTIOUTEN2_ADDR A:0x608130a8
y.create.l HWIO_QDSS_APB_DEC_CTI3_CTIOUTEN3_ADDR A:0x608130ac
y.create.l HWIO_QDSS_APB_DEC_CTI3_CTIOUTEN4_ADDR A:0x608130b0
y.create.l HWIO_QDSS_APB_DEC_CTI3_CTIOUTEN5_ADDR A:0x608130b4
y.create.l HWIO_QDSS_APB_DEC_CTI3_CTIOUTEN6_ADDR A:0x608130b8
y.create.l HWIO_QDSS_APB_DEC_CTI3_CTIOUTEN7_ADDR A:0x608130bc
y.create.l HWIO_QDSS_APB_DEC_CTI3_CTITRIGINSTATUS_ADDR A:0x60813130
y.create.l HWIO_QDSS_APB_DEC_CTI3_CTITRIGOUTSTATUS_ADDR A:0x60813134
y.create.l HWIO_QDSS_APB_DEC_CTI3_CTICHINSTATUS_ADDR A:0x60813138
y.create.l HWIO_QDSS_APB_DEC_CTI3_CTICHOUTSTATUS_ADDR A:0x6081313c
y.create.l HWIO_QDSS_APB_DEC_CTI3_CTIGATE_ADDR A:0x60813140
y.create.l HWIO_QDSS_APB_DEC_CTI3_ASICCTL_ADDR A:0x60813144
y.create.l HWIO_QDSS_APB_DEC_CTI3_ITCHINACK_ADDR A:0x60813edc
y.create.l HWIO_QDSS_APB_DEC_CTI3_ITTRIGINACK_ADDR A:0x60813ee0
y.create.l HWIO_QDSS_APB_DEC_CTI3_ITCHOUT_ADDR A:0x60813ee4
y.create.l HWIO_QDSS_APB_DEC_CTI3_ITTRIGOUT_ADDR A:0x60813ee8
y.create.l HWIO_QDSS_APB_DEC_CTI3_ITCHOUTACK_ADDR A:0x60813eec
y.create.l HWIO_QDSS_APB_DEC_CTI3_ITTRIGOUTACK_ADDR A:0x60813ef0
y.create.l HWIO_QDSS_APB_DEC_CTI3_ITCHIN_ADDR A:0x60813ef4
y.create.l HWIO_QDSS_APB_DEC_CTI3_ITTRIGIN_ADDR A:0x60813ef8
y.create.l HWIO_QDSS_APB_DEC_CTI3_ITCTRL_ADDR A:0x60813f00
y.create.l HWIO_QDSS_APB_DEC_CTI3_CLAIMSET_ADDR A:0x60813fa0
y.create.l HWIO_QDSS_APB_DEC_CTI3_CLAIMCLR_ADDR A:0x60813fa4
y.create.l HWIO_QDSS_APB_DEC_CTI3_LAR_ADDR A:0x60813fb0
y.create.l HWIO_QDSS_APB_DEC_CTI3_LSR_ADDR A:0x60813fb4
y.create.l HWIO_QDSS_APB_DEC_CTI3_AUTHSTATUS_ADDR A:0x60813fb8
y.create.l HWIO_QDSS_APB_DEC_CTI3_DEVID_ADDR A:0x60813fc8
y.create.l HWIO_QDSS_APB_DEC_CTI3_DEVTYPE_ADDR A:0x60813fcc
y.create.l HWIO_QDSS_APB_DEC_CTI3_PERIPHID0_ADDR A:0x60813fe0
y.create.l HWIO_QDSS_APB_DEC_CTI3_PERIPHID1_ADDR A:0x60813fe4
y.create.l HWIO_QDSS_APB_DEC_CTI3_PERIPHID2_ADDR A:0x60813fe8
y.create.l HWIO_QDSS_APB_DEC_CTI3_PERIPHID3_ADDR A:0x60813fec
y.create.l HWIO_QDSS_APB_DEC_CTI3_PERIPHID4_ADDR A:0x60813fd0
y.create.l HWIO_QDSS_APB_DEC_CTI3_PERIPHID5_ADDR A:0x60813fd4
y.create.l HWIO_QDSS_APB_DEC_CTI3_PERIPHID6_ADDR A:0x60813fd8
y.create.l HWIO_QDSS_APB_DEC_CTI3_PERIPHID7_ADDR A:0x60813fdc
y.create.l HWIO_QDSS_APB_DEC_CTI3_COMPID0_ADDR A:0x60813ff0
y.create.l HWIO_QDSS_APB_DEC_CTI3_COMPID1_ADDR A:0x60813ff4
y.create.l HWIO_QDSS_APB_DEC_CTI3_COMPID2_ADDR A:0x60813ff8
y.create.l HWIO_QDSS_APB_DEC_CTI3_COMPID3_ADDR A:0x60813ffc
y.create.l HWIO_QDSS_APB_DEC_CTI4_CTICONTROL_ADDR A:0x60814000
y.create.l HWIO_QDSS_APB_DEC_CTI4_CTIINTACK_ADDR A:0x60814010
y.create.l HWIO_QDSS_APB_DEC_CTI4_CTIAPPSET_ADDR A:0x60814014
y.create.l HWIO_QDSS_APB_DEC_CTI4_CTIAPPCLEAR_ADDR A:0x60814018
y.create.l HWIO_QDSS_APB_DEC_CTI4_CTIAPPPULSE_ADDR A:0x6081401c
y.create.l HWIO_QDSS_APB_DEC_CTI4_CTIINEN0_ADDR A:0x60814020
y.create.l HWIO_QDSS_APB_DEC_CTI4_CTIINEN1_ADDR A:0x60814024
y.create.l HWIO_QDSS_APB_DEC_CTI4_CTIINEN2_ADDR A:0x60814028
y.create.l HWIO_QDSS_APB_DEC_CTI4_CTIINEN3_ADDR A:0x6081402c
y.create.l HWIO_QDSS_APB_DEC_CTI4_CTIINEN4_ADDR A:0x60814030
y.create.l HWIO_QDSS_APB_DEC_CTI4_CTIINEN5_ADDR A:0x60814034
y.create.l HWIO_QDSS_APB_DEC_CTI4_CTIINEN6_ADDR A:0x60814038
y.create.l HWIO_QDSS_APB_DEC_CTI4_CTIINEN7_ADDR A:0x6081403c
y.create.l HWIO_QDSS_APB_DEC_CTI4_CTIOUTEN0_ADDR A:0x608140a0
y.create.l HWIO_QDSS_APB_DEC_CTI4_CTIOUTEN1_ADDR A:0x608140a4
y.create.l HWIO_QDSS_APB_DEC_CTI4_CTIOUTEN2_ADDR A:0x608140a8
y.create.l HWIO_QDSS_APB_DEC_CTI4_CTIOUTEN3_ADDR A:0x608140ac
y.create.l HWIO_QDSS_APB_DEC_CTI4_CTIOUTEN4_ADDR A:0x608140b0
y.create.l HWIO_QDSS_APB_DEC_CTI4_CTIOUTEN5_ADDR A:0x608140b4
y.create.l HWIO_QDSS_APB_DEC_CTI4_CTIOUTEN6_ADDR A:0x608140b8
y.create.l HWIO_QDSS_APB_DEC_CTI4_CTIOUTEN7_ADDR A:0x608140bc
y.create.l HWIO_QDSS_APB_DEC_CTI4_CTITRIGINSTATUS_ADDR A:0x60814130
y.create.l HWIO_QDSS_APB_DEC_CTI4_CTITRIGOUTSTATUS_ADDR A:0x60814134
y.create.l HWIO_QDSS_APB_DEC_CTI4_CTICHINSTATUS_ADDR A:0x60814138
y.create.l HWIO_QDSS_APB_DEC_CTI4_CTICHOUTSTATUS_ADDR A:0x6081413c
y.create.l HWIO_QDSS_APB_DEC_CTI4_CTIGATE_ADDR A:0x60814140
y.create.l HWIO_QDSS_APB_DEC_CTI4_ASICCTL_ADDR A:0x60814144
y.create.l HWIO_QDSS_APB_DEC_CTI4_ITCHINACK_ADDR A:0x60814edc
y.create.l HWIO_QDSS_APB_DEC_CTI4_ITTRIGINACK_ADDR A:0x60814ee0
y.create.l HWIO_QDSS_APB_DEC_CTI4_ITCHOUT_ADDR A:0x60814ee4
y.create.l HWIO_QDSS_APB_DEC_CTI4_ITTRIGOUT_ADDR A:0x60814ee8
y.create.l HWIO_QDSS_APB_DEC_CTI4_ITCHOUTACK_ADDR A:0x60814eec
y.create.l HWIO_QDSS_APB_DEC_CTI4_ITTRIGOUTACK_ADDR A:0x60814ef0
y.create.l HWIO_QDSS_APB_DEC_CTI4_ITCHIN_ADDR A:0x60814ef4
y.create.l HWIO_QDSS_APB_DEC_CTI4_ITTRIGIN_ADDR A:0x60814ef8
y.create.l HWIO_QDSS_APB_DEC_CTI4_ITCTRL_ADDR A:0x60814f00
y.create.l HWIO_QDSS_APB_DEC_CTI4_CLAIMSET_ADDR A:0x60814fa0
y.create.l HWIO_QDSS_APB_DEC_CTI4_CLAIMCLR_ADDR A:0x60814fa4
y.create.l HWIO_QDSS_APB_DEC_CTI4_LAR_ADDR A:0x60814fb0
y.create.l HWIO_QDSS_APB_DEC_CTI4_LSR_ADDR A:0x60814fb4
y.create.l HWIO_QDSS_APB_DEC_CTI4_AUTHSTATUS_ADDR A:0x60814fb8
y.create.l HWIO_QDSS_APB_DEC_CTI4_DEVID_ADDR A:0x60814fc8
y.create.l HWIO_QDSS_APB_DEC_CTI4_DEVTYPE_ADDR A:0x60814fcc
y.create.l HWIO_QDSS_APB_DEC_CTI4_PERIPHID0_ADDR A:0x60814fe0
y.create.l HWIO_QDSS_APB_DEC_CTI4_PERIPHID1_ADDR A:0x60814fe4
y.create.l HWIO_QDSS_APB_DEC_CTI4_PERIPHID2_ADDR A:0x60814fe8
y.create.l HWIO_QDSS_APB_DEC_CTI4_PERIPHID3_ADDR A:0x60814fec
y.create.l HWIO_QDSS_APB_DEC_CTI4_PERIPHID4_ADDR A:0x60814fd0
y.create.l HWIO_QDSS_APB_DEC_CTI4_PERIPHID5_ADDR A:0x60814fd4
y.create.l HWIO_QDSS_APB_DEC_CTI4_PERIPHID6_ADDR A:0x60814fd8
y.create.l HWIO_QDSS_APB_DEC_CTI4_PERIPHID7_ADDR A:0x60814fdc
y.create.l HWIO_QDSS_APB_DEC_CTI4_COMPID0_ADDR A:0x60814ff0
y.create.l HWIO_QDSS_APB_DEC_CTI4_COMPID1_ADDR A:0x60814ff4
y.create.l HWIO_QDSS_APB_DEC_CTI4_COMPID2_ADDR A:0x60814ff8
y.create.l HWIO_QDSS_APB_DEC_CTI4_COMPID3_ADDR A:0x60814ffc
y.create.l HWIO_QDSS_APB_DEC_CTI5_CTICONTROL_ADDR A:0x60815000
y.create.l HWIO_QDSS_APB_DEC_CTI5_CTIINTACK_ADDR A:0x60815010
y.create.l HWIO_QDSS_APB_DEC_CTI5_CTIAPPSET_ADDR A:0x60815014
y.create.l HWIO_QDSS_APB_DEC_CTI5_CTIAPPCLEAR_ADDR A:0x60815018
y.create.l HWIO_QDSS_APB_DEC_CTI5_CTIAPPPULSE_ADDR A:0x6081501c
y.create.l HWIO_QDSS_APB_DEC_CTI5_CTIINEN0_ADDR A:0x60815020
y.create.l HWIO_QDSS_APB_DEC_CTI5_CTIINEN1_ADDR A:0x60815024
y.create.l HWIO_QDSS_APB_DEC_CTI5_CTIINEN2_ADDR A:0x60815028
y.create.l HWIO_QDSS_APB_DEC_CTI5_CTIINEN3_ADDR A:0x6081502c
y.create.l HWIO_QDSS_APB_DEC_CTI5_CTIINEN4_ADDR A:0x60815030
y.create.l HWIO_QDSS_APB_DEC_CTI5_CTIINEN5_ADDR A:0x60815034
y.create.l HWIO_QDSS_APB_DEC_CTI5_CTIINEN6_ADDR A:0x60815038
y.create.l HWIO_QDSS_APB_DEC_CTI5_CTIINEN7_ADDR A:0x6081503c
y.create.l HWIO_QDSS_APB_DEC_CTI5_CTIOUTEN0_ADDR A:0x608150a0
y.create.l HWIO_QDSS_APB_DEC_CTI5_CTIOUTEN1_ADDR A:0x608150a4
y.create.l HWIO_QDSS_APB_DEC_CTI5_CTIOUTEN2_ADDR A:0x608150a8
y.create.l HWIO_QDSS_APB_DEC_CTI5_CTIOUTEN3_ADDR A:0x608150ac
y.create.l HWIO_QDSS_APB_DEC_CTI5_CTIOUTEN4_ADDR A:0x608150b0
y.create.l HWIO_QDSS_APB_DEC_CTI5_CTIOUTEN5_ADDR A:0x608150b4
y.create.l HWIO_QDSS_APB_DEC_CTI5_CTIOUTEN6_ADDR A:0x608150b8
y.create.l HWIO_QDSS_APB_DEC_CTI5_CTIOUTEN7_ADDR A:0x608150bc
y.create.l HWIO_QDSS_APB_DEC_CTI5_CTITRIGINSTATUS_ADDR A:0x60815130
y.create.l HWIO_QDSS_APB_DEC_CTI5_CTITRIGOUTSTATUS_ADDR A:0x60815134
y.create.l HWIO_QDSS_APB_DEC_CTI5_CTICHINSTATUS_ADDR A:0x60815138
y.create.l HWIO_QDSS_APB_DEC_CTI5_CTICHOUTSTATUS_ADDR A:0x6081513c
y.create.l HWIO_QDSS_APB_DEC_CTI5_CTIGATE_ADDR A:0x60815140
y.create.l HWIO_QDSS_APB_DEC_CTI5_ASICCTL_ADDR A:0x60815144
y.create.l HWIO_QDSS_APB_DEC_CTI5_ITCHINACK_ADDR A:0x60815edc
y.create.l HWIO_QDSS_APB_DEC_CTI5_ITTRIGINACK_ADDR A:0x60815ee0
y.create.l HWIO_QDSS_APB_DEC_CTI5_ITCHOUT_ADDR A:0x60815ee4
y.create.l HWIO_QDSS_APB_DEC_CTI5_ITTRIGOUT_ADDR A:0x60815ee8
y.create.l HWIO_QDSS_APB_DEC_CTI5_ITCHOUTACK_ADDR A:0x60815eec
y.create.l HWIO_QDSS_APB_DEC_CTI5_ITTRIGOUTACK_ADDR A:0x60815ef0
y.create.l HWIO_QDSS_APB_DEC_CTI5_ITCHIN_ADDR A:0x60815ef4
y.create.l HWIO_QDSS_APB_DEC_CTI5_ITTRIGIN_ADDR A:0x60815ef8
y.create.l HWIO_QDSS_APB_DEC_CTI5_ITCTRL_ADDR A:0x60815f00
y.create.l HWIO_QDSS_APB_DEC_CTI5_CLAIMSET_ADDR A:0x60815fa0
y.create.l HWIO_QDSS_APB_DEC_CTI5_CLAIMCLR_ADDR A:0x60815fa4
y.create.l HWIO_QDSS_APB_DEC_CTI5_LAR_ADDR A:0x60815fb0
y.create.l HWIO_QDSS_APB_DEC_CTI5_LSR_ADDR A:0x60815fb4
y.create.l HWIO_QDSS_APB_DEC_CTI5_AUTHSTATUS_ADDR A:0x60815fb8
y.create.l HWIO_QDSS_APB_DEC_CTI5_DEVID_ADDR A:0x60815fc8
y.create.l HWIO_QDSS_APB_DEC_CTI5_DEVTYPE_ADDR A:0x60815fcc
y.create.l HWIO_QDSS_APB_DEC_CTI5_PERIPHID0_ADDR A:0x60815fe0
y.create.l HWIO_QDSS_APB_DEC_CTI5_PERIPHID1_ADDR A:0x60815fe4
y.create.l HWIO_QDSS_APB_DEC_CTI5_PERIPHID2_ADDR A:0x60815fe8
y.create.l HWIO_QDSS_APB_DEC_CTI5_PERIPHID3_ADDR A:0x60815fec
y.create.l HWIO_QDSS_APB_DEC_CTI5_PERIPHID4_ADDR A:0x60815fd0
y.create.l HWIO_QDSS_APB_DEC_CTI5_PERIPHID5_ADDR A:0x60815fd4
y.create.l HWIO_QDSS_APB_DEC_CTI5_PERIPHID6_ADDR A:0x60815fd8
y.create.l HWIO_QDSS_APB_DEC_CTI5_PERIPHID7_ADDR A:0x60815fdc
y.create.l HWIO_QDSS_APB_DEC_CTI5_COMPID0_ADDR A:0x60815ff0
y.create.l HWIO_QDSS_APB_DEC_CTI5_COMPID1_ADDR A:0x60815ff4
y.create.l HWIO_QDSS_APB_DEC_CTI5_COMPID2_ADDR A:0x60815ff8
y.create.l HWIO_QDSS_APB_DEC_CTI5_COMPID3_ADDR A:0x60815ffc
y.create.l HWIO_QDSS_APB_DEC_CTI6_CTICONTROL_ADDR A:0x60816000
y.create.l HWIO_QDSS_APB_DEC_CTI6_CTIINTACK_ADDR A:0x60816010
y.create.l HWIO_QDSS_APB_DEC_CTI6_CTIAPPSET_ADDR A:0x60816014
y.create.l HWIO_QDSS_APB_DEC_CTI6_CTIAPPCLEAR_ADDR A:0x60816018
y.create.l HWIO_QDSS_APB_DEC_CTI6_CTIAPPPULSE_ADDR A:0x6081601c
y.create.l HWIO_QDSS_APB_DEC_CTI6_CTIINEN0_ADDR A:0x60816020
y.create.l HWIO_QDSS_APB_DEC_CTI6_CTIINEN1_ADDR A:0x60816024
y.create.l HWIO_QDSS_APB_DEC_CTI6_CTIINEN2_ADDR A:0x60816028
y.create.l HWIO_QDSS_APB_DEC_CTI6_CTIINEN3_ADDR A:0x6081602c
y.create.l HWIO_QDSS_APB_DEC_CTI6_CTIINEN4_ADDR A:0x60816030
y.create.l HWIO_QDSS_APB_DEC_CTI6_CTIINEN5_ADDR A:0x60816034
y.create.l HWIO_QDSS_APB_DEC_CTI6_CTIINEN6_ADDR A:0x60816038
y.create.l HWIO_QDSS_APB_DEC_CTI6_CTIINEN7_ADDR A:0x6081603c
y.create.l HWIO_QDSS_APB_DEC_CTI6_CTIOUTEN0_ADDR A:0x608160a0
y.create.l HWIO_QDSS_APB_DEC_CTI6_CTIOUTEN1_ADDR A:0x608160a4
y.create.l HWIO_QDSS_APB_DEC_CTI6_CTIOUTEN2_ADDR A:0x608160a8
y.create.l HWIO_QDSS_APB_DEC_CTI6_CTIOUTEN3_ADDR A:0x608160ac
y.create.l HWIO_QDSS_APB_DEC_CTI6_CTIOUTEN4_ADDR A:0x608160b0
y.create.l HWIO_QDSS_APB_DEC_CTI6_CTIOUTEN5_ADDR A:0x608160b4
y.create.l HWIO_QDSS_APB_DEC_CTI6_CTIOUTEN6_ADDR A:0x608160b8
y.create.l HWIO_QDSS_APB_DEC_CTI6_CTIOUTEN7_ADDR A:0x608160bc
y.create.l HWIO_QDSS_APB_DEC_CTI6_CTITRIGINSTATUS_ADDR A:0x60816130
y.create.l HWIO_QDSS_APB_DEC_CTI6_CTITRIGOUTSTATUS_ADDR A:0x60816134
y.create.l HWIO_QDSS_APB_DEC_CTI6_CTICHINSTATUS_ADDR A:0x60816138
y.create.l HWIO_QDSS_APB_DEC_CTI6_CTICHOUTSTATUS_ADDR A:0x6081613c
y.create.l HWIO_QDSS_APB_DEC_CTI6_CTIGATE_ADDR A:0x60816140
y.create.l HWIO_QDSS_APB_DEC_CTI6_ASICCTL_ADDR A:0x60816144
y.create.l HWIO_QDSS_APB_DEC_CTI6_ITCHINACK_ADDR A:0x60816edc
y.create.l HWIO_QDSS_APB_DEC_CTI6_ITTRIGINACK_ADDR A:0x60816ee0
y.create.l HWIO_QDSS_APB_DEC_CTI6_ITCHOUT_ADDR A:0x60816ee4
y.create.l HWIO_QDSS_APB_DEC_CTI6_ITTRIGOUT_ADDR A:0x60816ee8
y.create.l HWIO_QDSS_APB_DEC_CTI6_ITCHOUTACK_ADDR A:0x60816eec
y.create.l HWIO_QDSS_APB_DEC_CTI6_ITTRIGOUTACK_ADDR A:0x60816ef0
y.create.l HWIO_QDSS_APB_DEC_CTI6_ITCHIN_ADDR A:0x60816ef4
y.create.l HWIO_QDSS_APB_DEC_CTI6_ITTRIGIN_ADDR A:0x60816ef8
y.create.l HWIO_QDSS_APB_DEC_CTI6_ITCTRL_ADDR A:0x60816f00
y.create.l HWIO_QDSS_APB_DEC_CTI6_CLAIMSET_ADDR A:0x60816fa0
y.create.l HWIO_QDSS_APB_DEC_CTI6_CLAIMCLR_ADDR A:0x60816fa4
y.create.l HWIO_QDSS_APB_DEC_CTI6_LAR_ADDR A:0x60816fb0
y.create.l HWIO_QDSS_APB_DEC_CTI6_LSR_ADDR A:0x60816fb4
y.create.l HWIO_QDSS_APB_DEC_CTI6_AUTHSTATUS_ADDR A:0x60816fb8
y.create.l HWIO_QDSS_APB_DEC_CTI6_DEVID_ADDR A:0x60816fc8
y.create.l HWIO_QDSS_APB_DEC_CTI6_DEVTYPE_ADDR A:0x60816fcc
y.create.l HWIO_QDSS_APB_DEC_CTI6_PERIPHID0_ADDR A:0x60816fe0
y.create.l HWIO_QDSS_APB_DEC_CTI6_PERIPHID1_ADDR A:0x60816fe4
y.create.l HWIO_QDSS_APB_DEC_CTI6_PERIPHID2_ADDR A:0x60816fe8
y.create.l HWIO_QDSS_APB_DEC_CTI6_PERIPHID3_ADDR A:0x60816fec
y.create.l HWIO_QDSS_APB_DEC_CTI6_PERIPHID4_ADDR A:0x60816fd0
y.create.l HWIO_QDSS_APB_DEC_CTI6_PERIPHID5_ADDR A:0x60816fd4
y.create.l HWIO_QDSS_APB_DEC_CTI6_PERIPHID6_ADDR A:0x60816fd8
y.create.l HWIO_QDSS_APB_DEC_CTI6_PERIPHID7_ADDR A:0x60816fdc
y.create.l HWIO_QDSS_APB_DEC_CTI6_COMPID0_ADDR A:0x60816ff0
y.create.l HWIO_QDSS_APB_DEC_CTI6_COMPID1_ADDR A:0x60816ff4
y.create.l HWIO_QDSS_APB_DEC_CTI6_COMPID2_ADDR A:0x60816ff8
y.create.l HWIO_QDSS_APB_DEC_CTI6_COMPID3_ADDR A:0x60816ffc
y.create.l HWIO_QDSS_APB_DEC_CTI7_CTICONTROL_ADDR A:0x60817000
y.create.l HWIO_QDSS_APB_DEC_CTI7_CTIINTACK_ADDR A:0x60817010
y.create.l HWIO_QDSS_APB_DEC_CTI7_CTIAPPSET_ADDR A:0x60817014
y.create.l HWIO_QDSS_APB_DEC_CTI7_CTIAPPCLEAR_ADDR A:0x60817018
y.create.l HWIO_QDSS_APB_DEC_CTI7_CTIAPPPULSE_ADDR A:0x6081701c
y.create.l HWIO_QDSS_APB_DEC_CTI7_CTIINEN0_ADDR A:0x60817020
y.create.l HWIO_QDSS_APB_DEC_CTI7_CTIINEN1_ADDR A:0x60817024
y.create.l HWIO_QDSS_APB_DEC_CTI7_CTIINEN2_ADDR A:0x60817028
y.create.l HWIO_QDSS_APB_DEC_CTI7_CTIINEN3_ADDR A:0x6081702c
y.create.l HWIO_QDSS_APB_DEC_CTI7_CTIINEN4_ADDR A:0x60817030
y.create.l HWIO_QDSS_APB_DEC_CTI7_CTIINEN5_ADDR A:0x60817034
y.create.l HWIO_QDSS_APB_DEC_CTI7_CTIINEN6_ADDR A:0x60817038
y.create.l HWIO_QDSS_APB_DEC_CTI7_CTIINEN7_ADDR A:0x6081703c
y.create.l HWIO_QDSS_APB_DEC_CTI7_CTIOUTEN0_ADDR A:0x608170a0
y.create.l HWIO_QDSS_APB_DEC_CTI7_CTIOUTEN1_ADDR A:0x608170a4
y.create.l HWIO_QDSS_APB_DEC_CTI7_CTIOUTEN2_ADDR A:0x608170a8
y.create.l HWIO_QDSS_APB_DEC_CTI7_CTIOUTEN3_ADDR A:0x608170ac
y.create.l HWIO_QDSS_APB_DEC_CTI7_CTIOUTEN4_ADDR A:0x608170b0
y.create.l HWIO_QDSS_APB_DEC_CTI7_CTIOUTEN5_ADDR A:0x608170b4
y.create.l HWIO_QDSS_APB_DEC_CTI7_CTIOUTEN6_ADDR A:0x608170b8
y.create.l HWIO_QDSS_APB_DEC_CTI7_CTIOUTEN7_ADDR A:0x608170bc
y.create.l HWIO_QDSS_APB_DEC_CTI7_CTITRIGINSTATUS_ADDR A:0x60817130
y.create.l HWIO_QDSS_APB_DEC_CTI7_CTITRIGOUTSTATUS_ADDR A:0x60817134
y.create.l HWIO_QDSS_APB_DEC_CTI7_CTICHINSTATUS_ADDR A:0x60817138
y.create.l HWIO_QDSS_APB_DEC_CTI7_CTICHOUTSTATUS_ADDR A:0x6081713c
y.create.l HWIO_QDSS_APB_DEC_CTI7_CTIGATE_ADDR A:0x60817140
y.create.l HWIO_QDSS_APB_DEC_CTI7_ASICCTL_ADDR A:0x60817144
y.create.l HWIO_QDSS_APB_DEC_CTI7_ITCHINACK_ADDR A:0x60817edc
y.create.l HWIO_QDSS_APB_DEC_CTI7_ITTRIGINACK_ADDR A:0x60817ee0
y.create.l HWIO_QDSS_APB_DEC_CTI7_ITCHOUT_ADDR A:0x60817ee4
y.create.l HWIO_QDSS_APB_DEC_CTI7_ITTRIGOUT_ADDR A:0x60817ee8
y.create.l HWIO_QDSS_APB_DEC_CTI7_ITCHOUTACK_ADDR A:0x60817eec
y.create.l HWIO_QDSS_APB_DEC_CTI7_ITTRIGOUTACK_ADDR A:0x60817ef0
y.create.l HWIO_QDSS_APB_DEC_CTI7_ITCHIN_ADDR A:0x60817ef4
y.create.l HWIO_QDSS_APB_DEC_CTI7_ITTRIGIN_ADDR A:0x60817ef8
y.create.l HWIO_QDSS_APB_DEC_CTI7_ITCTRL_ADDR A:0x60817f00
y.create.l HWIO_QDSS_APB_DEC_CTI7_CLAIMSET_ADDR A:0x60817fa0
y.create.l HWIO_QDSS_APB_DEC_CTI7_CLAIMCLR_ADDR A:0x60817fa4
y.create.l HWIO_QDSS_APB_DEC_CTI7_LAR_ADDR A:0x60817fb0
y.create.l HWIO_QDSS_APB_DEC_CTI7_LSR_ADDR A:0x60817fb4
y.create.l HWIO_QDSS_APB_DEC_CTI7_AUTHSTATUS_ADDR A:0x60817fb8
y.create.l HWIO_QDSS_APB_DEC_CTI7_DEVID_ADDR A:0x60817fc8
y.create.l HWIO_QDSS_APB_DEC_CTI7_DEVTYPE_ADDR A:0x60817fcc
y.create.l HWIO_QDSS_APB_DEC_CTI7_PERIPHID0_ADDR A:0x60817fe0
y.create.l HWIO_QDSS_APB_DEC_CTI7_PERIPHID1_ADDR A:0x60817fe4
y.create.l HWIO_QDSS_APB_DEC_CTI7_PERIPHID2_ADDR A:0x60817fe8
y.create.l HWIO_QDSS_APB_DEC_CTI7_PERIPHID3_ADDR A:0x60817fec
y.create.l HWIO_QDSS_APB_DEC_CTI7_PERIPHID4_ADDR A:0x60817fd0
y.create.l HWIO_QDSS_APB_DEC_CTI7_PERIPHID5_ADDR A:0x60817fd4
y.create.l HWIO_QDSS_APB_DEC_CTI7_PERIPHID6_ADDR A:0x60817fd8
y.create.l HWIO_QDSS_APB_DEC_CTI7_PERIPHID7_ADDR A:0x60817fdc
y.create.l HWIO_QDSS_APB_DEC_CTI7_COMPID0_ADDR A:0x60817ff0
y.create.l HWIO_QDSS_APB_DEC_CTI7_COMPID1_ADDR A:0x60817ff4
y.create.l HWIO_QDSS_APB_DEC_CTI7_COMPID2_ADDR A:0x60817ff8
y.create.l HWIO_QDSS_APB_DEC_CTI7_COMPID3_ADDR A:0x60817ffc
y.create.l HWIO_QDSS_APB_DEC_CTI8_CTICONTROL_ADDR A:0x60818000
y.create.l HWIO_QDSS_APB_DEC_CTI8_CTIINTACK_ADDR A:0x60818010
y.create.l HWIO_QDSS_APB_DEC_CTI8_CTIAPPSET_ADDR A:0x60818014
y.create.l HWIO_QDSS_APB_DEC_CTI8_CTIAPPCLEAR_ADDR A:0x60818018
y.create.l HWIO_QDSS_APB_DEC_CTI8_CTIAPPPULSE_ADDR A:0x6081801c
y.create.l HWIO_QDSS_APB_DEC_CTI8_CTIINEN0_ADDR A:0x60818020
y.create.l HWIO_QDSS_APB_DEC_CTI8_CTIINEN1_ADDR A:0x60818024
y.create.l HWIO_QDSS_APB_DEC_CTI8_CTIINEN2_ADDR A:0x60818028
y.create.l HWIO_QDSS_APB_DEC_CTI8_CTIINEN3_ADDR A:0x6081802c
y.create.l HWIO_QDSS_APB_DEC_CTI8_CTIINEN4_ADDR A:0x60818030
y.create.l HWIO_QDSS_APB_DEC_CTI8_CTIINEN5_ADDR A:0x60818034
y.create.l HWIO_QDSS_APB_DEC_CTI8_CTIINEN6_ADDR A:0x60818038
y.create.l HWIO_QDSS_APB_DEC_CTI8_CTIINEN7_ADDR A:0x6081803c
y.create.l HWIO_QDSS_APB_DEC_CTI8_CTIOUTEN0_ADDR A:0x608180a0
y.create.l HWIO_QDSS_APB_DEC_CTI8_CTIOUTEN1_ADDR A:0x608180a4
y.create.l HWIO_QDSS_APB_DEC_CTI8_CTIOUTEN2_ADDR A:0x608180a8
y.create.l HWIO_QDSS_APB_DEC_CTI8_CTIOUTEN3_ADDR A:0x608180ac
y.create.l HWIO_QDSS_APB_DEC_CTI8_CTIOUTEN4_ADDR A:0x608180b0
y.create.l HWIO_QDSS_APB_DEC_CTI8_CTIOUTEN5_ADDR A:0x608180b4
y.create.l HWIO_QDSS_APB_DEC_CTI8_CTIOUTEN6_ADDR A:0x608180b8
y.create.l HWIO_QDSS_APB_DEC_CTI8_CTIOUTEN7_ADDR A:0x608180bc
y.create.l HWIO_QDSS_APB_DEC_CTI8_CTITRIGINSTATUS_ADDR A:0x60818130
y.create.l HWIO_QDSS_APB_DEC_CTI8_CTITRIGOUTSTATUS_ADDR A:0x60818134
y.create.l HWIO_QDSS_APB_DEC_CTI8_CTICHINSTATUS_ADDR A:0x60818138
y.create.l HWIO_QDSS_APB_DEC_CTI8_CTICHOUTSTATUS_ADDR A:0x6081813c
y.create.l HWIO_QDSS_APB_DEC_CTI8_CTIGATE_ADDR A:0x60818140
y.create.l HWIO_QDSS_APB_DEC_CTI8_ASICCTL_ADDR A:0x60818144
y.create.l HWIO_QDSS_APB_DEC_CTI8_ITCHINACK_ADDR A:0x60818edc
y.create.l HWIO_QDSS_APB_DEC_CTI8_ITTRIGINACK_ADDR A:0x60818ee0
y.create.l HWIO_QDSS_APB_DEC_CTI8_ITCHOUT_ADDR A:0x60818ee4
y.create.l HWIO_QDSS_APB_DEC_CTI8_ITTRIGOUT_ADDR A:0x60818ee8
y.create.l HWIO_QDSS_APB_DEC_CTI8_ITCHOUTACK_ADDR A:0x60818eec
y.create.l HWIO_QDSS_APB_DEC_CTI8_ITTRIGOUTACK_ADDR A:0x60818ef0
y.create.l HWIO_QDSS_APB_DEC_CTI8_ITCHIN_ADDR A:0x60818ef4
y.create.l HWIO_QDSS_APB_DEC_CTI8_ITTRIGIN_ADDR A:0x60818ef8
y.create.l HWIO_QDSS_APB_DEC_CTI8_ITCTRL_ADDR A:0x60818f00
y.create.l HWIO_QDSS_APB_DEC_CTI8_CLAIMSET_ADDR A:0x60818fa0
y.create.l HWIO_QDSS_APB_DEC_CTI8_CLAIMCLR_ADDR A:0x60818fa4
y.create.l HWIO_QDSS_APB_DEC_CTI8_LAR_ADDR A:0x60818fb0
y.create.l HWIO_QDSS_APB_DEC_CTI8_LSR_ADDR A:0x60818fb4
y.create.l HWIO_QDSS_APB_DEC_CTI8_AUTHSTATUS_ADDR A:0x60818fb8
y.create.l HWIO_QDSS_APB_DEC_CTI8_DEVID_ADDR A:0x60818fc8
y.create.l HWIO_QDSS_APB_DEC_CTI8_DEVTYPE_ADDR A:0x60818fcc
y.create.l HWIO_QDSS_APB_DEC_CTI8_PERIPHID0_ADDR A:0x60818fe0
y.create.l HWIO_QDSS_APB_DEC_CTI8_PERIPHID1_ADDR A:0x60818fe4
y.create.l HWIO_QDSS_APB_DEC_CTI8_PERIPHID2_ADDR A:0x60818fe8
y.create.l HWIO_QDSS_APB_DEC_CTI8_PERIPHID3_ADDR A:0x60818fec
y.create.l HWIO_QDSS_APB_DEC_CTI8_PERIPHID4_ADDR A:0x60818fd0
y.create.l HWIO_QDSS_APB_DEC_CTI8_PERIPHID5_ADDR A:0x60818fd4
y.create.l HWIO_QDSS_APB_DEC_CTI8_PERIPHID6_ADDR A:0x60818fd8
y.create.l HWIO_QDSS_APB_DEC_CTI8_PERIPHID7_ADDR A:0x60818fdc
y.create.l HWIO_QDSS_APB_DEC_CTI8_COMPID0_ADDR A:0x60818ff0
y.create.l HWIO_QDSS_APB_DEC_CTI8_COMPID1_ADDR A:0x60818ff4
y.create.l HWIO_QDSS_APB_DEC_CTI8_COMPID2_ADDR A:0x60818ff8
y.create.l HWIO_QDSS_APB_DEC_CTI8_COMPID3_ADDR A:0x60818ffc
y.create.l HWIO_QDSS_APB_DEC_CSTPIU_SUPPORTED_PORT_SIZES_ADDR A:0x60820000
y.create.l HWIO_QDSS_APB_DEC_CSTPIU_CURRENT_PORT_SIZE_ADDR A:0x60820004
y.create.l HWIO_QDSS_APB_DEC_CSTPIU_SUPPORTED_TRIGGER_MODES_ADDR A:0x60820100
y.create.l HWIO_QDSS_APB_DEC_CSTPIU_TRIGGER_COUNTER_VALUE_ADDR A:0x60820104
y.create.l HWIO_QDSS_APB_DEC_CSTPIU_TRIGGER_MULTIPLIER_ADDR A:0x60820108
y.create.l HWIO_QDSS_APB_DEC_CSTPIU_SUPPORTED_TEST_PATTERN_MODES_ADDR A:0x60820200
y.create.l HWIO_QDSS_APB_DEC_CSTPIU_CURRENT_TEST_PATTERN_MODE_ADDR A:0x60820204
y.create.l HWIO_QDSS_APB_DEC_CSTPIU_TPRCR_ADDR A:0x60820208
y.create.l HWIO_QDSS_APB_DEC_CSTPIU_FFSR_ADDR A:0x60820300
y.create.l HWIO_QDSS_APB_DEC_CSTPIU_FFCR_ADDR A:0x60820304
y.create.l HWIO_QDSS_APB_DEC_CSTPIU_FSCR_ADDR A:0x60820308
y.create.l HWIO_QDSS_APB_DEC_CSTPIU_EXTCTL_IN_PORT_ADDR A:0x60820400
y.create.l HWIO_QDSS_APB_DEC_CSTPIU_EXTCTL_OUT_PORT_ADDR A:0x60820404
y.create.l HWIO_QDSS_APB_DEC_CSTPIU_ITTRFLINACK_ADDR A:0x60820ee4
y.create.l HWIO_QDSS_APB_DEC_CSTPIU_ITTRFLIN_ADDR A:0x60820ee8
y.create.l HWIO_QDSS_APB_DEC_CSTPIU_ITATBDATA0_ADDR A:0x60820eec
y.create.l HWIO_QDSS_APB_DEC_CSTPIU_ITATBCTR2_ADDR A:0x60820ef0
y.create.l HWIO_QDSS_APB_DEC_CSTPIU_ITATBCTR1_ADDR A:0x60820ef4
y.create.l HWIO_QDSS_APB_DEC_CSTPIU_ITATBCTR0_ADDR A:0x60820ef8
y.create.l HWIO_QDSS_APB_DEC_CSTPIU_ITCTRL_ADDR A:0x60820f00
y.create.l HWIO_QDSS_APB_DEC_CSTPIU_CLAIMSET_ADDR A:0x60820fa0
y.create.l HWIO_QDSS_APB_DEC_CSTPIU_CLAIMCLR_ADDR A:0x60820fa4
y.create.l HWIO_QDSS_APB_DEC_CSTPIU_LAR_ADDR A:0x60820fb0
y.create.l HWIO_QDSS_APB_DEC_CSTPIU_LSR_ADDR A:0x60820fb4
y.create.l HWIO_QDSS_APB_DEC_CSTPIU_AUTHSTATUS_ADDR A:0x60820fb8
y.create.l HWIO_QDSS_APB_DEC_CSTPIU_DEVID_ADDR A:0x60820fc8
y.create.l HWIO_QDSS_APB_DEC_CSTPIU_DEVTYPE_ADDR A:0x60820fcc
y.create.l HWIO_QDSS_APB_DEC_CSTPIU_PERIPHID0_ADDR A:0x60820fe0
y.create.l HWIO_QDSS_APB_DEC_CSTPIU_PERIPHID1_ADDR A:0x60820fe4
y.create.l HWIO_QDSS_APB_DEC_CSTPIU_PERIPHID2_ADDR A:0x60820fe8
y.create.l HWIO_QDSS_APB_DEC_CSTPIU_PERIPHID3_ADDR A:0x60820fec
y.create.l HWIO_QDSS_APB_DEC_CSTPIU_PERIPHID4_ADDR A:0x60820fd0
y.create.l HWIO_QDSS_APB_DEC_CSTPIU_PERIPHID5_ADDR A:0x60820fd4
y.create.l HWIO_QDSS_APB_DEC_CSTPIU_PERIPHID6_ADDR A:0x60820fd8
y.create.l HWIO_QDSS_APB_DEC_CSTPIU_PERIPHID7_ADDR A:0x60820fdc
y.create.l HWIO_QDSS_APB_DEC_CSTPIU_COMPID0_ADDR A:0x60820ff0
y.create.l HWIO_QDSS_APB_DEC_CSTPIU_COMPID1_ADDR A:0x60820ff4
y.create.l HWIO_QDSS_APB_DEC_CSTPIU_COMPID2_ADDR A:0x60820ff8
y.create.l HWIO_QDSS_APB_DEC_CSTPIU_COMPID3_ADDR A:0x60820ffc
y.create.l HWIO_QDSS_APB_DEC_IN_FUN0_CTRL_REG_ADDR A:0x60821000
y.create.l HWIO_QDSS_APB_DEC_IN_FUN0_PRIORITY_CTRL_REG_ADDR A:0x60821004
y.create.l HWIO_QDSS_APB_DEC_IN_FUN0_ITATBDATA0_ADDR A:0x60821eec
y.create.l HWIO_QDSS_APB_DEC_IN_FUN0_ITATBCTR2_ADDR A:0x60821ef0
y.create.l HWIO_QDSS_APB_DEC_IN_FUN0_ITATBCTR1_ADDR A:0x60821ef4
y.create.l HWIO_QDSS_APB_DEC_IN_FUN0_ITATBCTR0_ADDR A:0x60821ef8
y.create.l HWIO_QDSS_APB_DEC_IN_FUN0_ITCTRL_ADDR A:0x60821f00
y.create.l HWIO_QDSS_APB_DEC_IN_FUN0_CLAIMSET_ADDR A:0x60821fa0
y.create.l HWIO_QDSS_APB_DEC_IN_FUN0_CLAIMCLR_ADDR A:0x60821fa4
y.create.l HWIO_QDSS_APB_DEC_IN_FUN0_LOCKACCESS_ADDR A:0x60821fb0
y.create.l HWIO_QDSS_APB_DEC_IN_FUN0_LOCKSTATUS_ADDR A:0x60821fb4
y.create.l HWIO_QDSS_APB_DEC_IN_FUN0_AUTHSTATUS_ADDR A:0x60821fb8
y.create.l HWIO_QDSS_APB_DEC_IN_FUN0_DEVID_ADDR A:0x60821fc8
y.create.l HWIO_QDSS_APB_DEC_IN_FUN0_DEVTYPE_ADDR A:0x60821fcc
y.create.l HWIO_QDSS_APB_DEC_IN_FUN0_PERIPHID0_ADDR A:0x60821fe0
y.create.l HWIO_QDSS_APB_DEC_IN_FUN0_PERIPHID1_ADDR A:0x60821fe4
y.create.l HWIO_QDSS_APB_DEC_IN_FUN0_PERIPHID2_ADDR A:0x60821fe8
y.create.l HWIO_QDSS_APB_DEC_IN_FUN0_PERIPHID3_ADDR A:0x60821fec
y.create.l HWIO_QDSS_APB_DEC_IN_FUN0_PERIPHID4_ADDR A:0x60821fd0
y.create.l HWIO_QDSS_APB_DEC_IN_FUN0_PERIPHID5_ADDR A:0x60821fd4
y.create.l HWIO_QDSS_APB_DEC_IN_FUN0_PERIPHID6_ADDR A:0x60821fd8
y.create.l HWIO_QDSS_APB_DEC_IN_FUN0_PERIPHID7_ADDR A:0x60821fdc
y.create.l HWIO_QDSS_APB_DEC_IN_FUN0_COMPID0_ADDR A:0x60821ff0
y.create.l HWIO_QDSS_APB_DEC_IN_FUN0_COMPID1_ADDR A:0x60821ff4
y.create.l HWIO_QDSS_APB_DEC_IN_FUN0_COMPID2_ADDR A:0x60821ff8
y.create.l HWIO_QDSS_APB_DEC_IN_FUN0_COMPID3_ADDR A:0x60821ffc
y.create.l HWIO_QDSS_APB_DEC_REPL64_IDFILTER0_ADDR A:0x60824000
y.create.l HWIO_QDSS_APB_DEC_REPL64_IDFILTER1_ADDR A:0x60824004
y.create.l HWIO_QDSS_APB_DEC_REPL64_ITATBCTR0_ADDR A:0x60824efc
y.create.l HWIO_QDSS_APB_DEC_REPL64_ITATBCTR1_ADDR A:0x60824ef8
y.create.l HWIO_QDSS_APB_DEC_REPL64_ITCTRL_ADDR A:0x60824f00
y.create.l HWIO_QDSS_APB_DEC_REPL64_CLAIMSET_ADDR A:0x60824fa0
y.create.l HWIO_QDSS_APB_DEC_REPL64_CLAIMCLR_ADDR A:0x60824fa4
y.create.l HWIO_QDSS_APB_DEC_REPL64_LAR_ADDR A:0x60824fb0
y.create.l HWIO_QDSS_APB_DEC_REPL64_LSR_ADDR A:0x60824fb4
y.create.l HWIO_QDSS_APB_DEC_REPL64_AUTHSTATUS_ADDR A:0x60824fb8
y.create.l HWIO_QDSS_APB_DEC_REPL64_DEVID_ADDR A:0x60824fc8
y.create.l HWIO_QDSS_APB_DEC_REPL64_DEVTYPE_ADDR A:0x60824fcc
y.create.l HWIO_QDSS_APB_DEC_REPL64_PIDR0_ADDR A:0x60824fe0
y.create.l HWIO_QDSS_APB_DEC_REPL64_PIDR1_ADDR A:0x60824fe4
y.create.l HWIO_QDSS_APB_DEC_REPL64_PIDR2_ADDR A:0x60824fe8
y.create.l HWIO_QDSS_APB_DEC_REPL64_PIDR3_ADDR A:0x60824fec
y.create.l HWIO_QDSS_APB_DEC_REPL64_PIDR4_ADDR A:0x60824fd0
y.create.l HWIO_QDSS_APB_DEC_REPL64_PIDR5_ADDR A:0x60824fd4
y.create.l HWIO_QDSS_APB_DEC_REPL64_PIDR6_ADDR A:0x60824fd8
y.create.l HWIO_QDSS_APB_DEC_REPL64_PIDR7_ADDR A:0x60824fdc
y.create.l HWIO_QDSS_APB_DEC_REPL64_CIDR0_ADDR A:0x60824ff0
y.create.l HWIO_QDSS_APB_DEC_REPL64_CIDR1_ADDR A:0x60824ff4
y.create.l HWIO_QDSS_APB_DEC_REPL64_CIDR2_ADDR A:0x60824ff8
y.create.l HWIO_QDSS_APB_DEC_REPL64_CIDR3_ADDR A:0x60824ffc
y.create.l HWIO_QDSS_APB_DEC_ETFETB_RSZ_ADDR A:0x60825004
y.create.l HWIO_QDSS_APB_DEC_ETFETB_STS_ADDR A:0x6082500c
y.create.l HWIO_QDSS_APB_DEC_ETFETB_RRD_ADDR A:0x60825010
y.create.l HWIO_QDSS_APB_DEC_ETFETB_RRP_ADDR A:0x60825014
y.create.l HWIO_QDSS_APB_DEC_ETFETB_RWP_ADDR A:0x60825018
y.create.l HWIO_QDSS_APB_DEC_ETFETB_TRG_ADDR A:0x6082501c
y.create.l HWIO_QDSS_APB_DEC_ETFETB_CTL_ADDR A:0x60825020
y.create.l HWIO_QDSS_APB_DEC_ETFETB_RWD_ADDR A:0x60825024
y.create.l HWIO_QDSS_APB_DEC_ETFETB_MODE_ADDR A:0x60825028
y.create.l HWIO_QDSS_APB_DEC_ETFETB_LBUFLEVEL_ADDR A:0x6082502c
y.create.l HWIO_QDSS_APB_DEC_ETFETB_CBUFLEVEL_ADDR A:0x60825030
y.create.l HWIO_QDSS_APB_DEC_ETFETB_BUFWM_ADDR A:0x60825034
y.create.l HWIO_QDSS_APB_DEC_ETFETB_FFSR_ADDR A:0x60825300
y.create.l HWIO_QDSS_APB_DEC_ETFETB_FFCR_ADDR A:0x60825304
y.create.l HWIO_QDSS_APB_DEC_ETFETB_PSCR_ADDR A:0x60825308
y.create.l HWIO_QDSS_APB_DEC_ETFETB_ITATBMDATA0_ADDR A:0x60825ed0
y.create.l HWIO_QDSS_APB_DEC_ETFETB_ITATBMCTR2_ADDR A:0x60825ed4
y.create.l HWIO_QDSS_APB_DEC_ETFETB_ITATBMCTR1_ADDR A:0x60825ed8
y.create.l HWIO_QDSS_APB_DEC_ETFETB_ITATBMCTR0_ADDR A:0x60825edc
y.create.l HWIO_QDSS_APB_DEC_ETFETB_ITMISCOP0_ADDR A:0x60825ee0
y.create.l HWIO_QDSS_APB_DEC_ETFETB_ITTRFLIN_ADDR A:0x60825ee8
y.create.l HWIO_QDSS_APB_DEC_ETFETB_ITATBDATA0_ADDR A:0x60825eec
y.create.l HWIO_QDSS_APB_DEC_ETFETB_ITATBCTR2_ADDR A:0x60825ef0
y.create.l HWIO_QDSS_APB_DEC_ETFETB_ITATBCTR1_ADDR A:0x60825ef4
y.create.l HWIO_QDSS_APB_DEC_ETFETB_ITATBCTR0_ADDR A:0x60825ef8
y.create.l HWIO_QDSS_APB_DEC_ETFETB_ITCTRL_ADDR A:0x60825f00
y.create.l HWIO_QDSS_APB_DEC_ETFETB_CLAIMSET_ADDR A:0x60825fa0
y.create.l HWIO_QDSS_APB_DEC_ETFETB_CLAIMCLR_ADDR A:0x60825fa4
y.create.l HWIO_QDSS_APB_DEC_ETFETB_LAR_ADDR A:0x60825fb0
y.create.l HWIO_QDSS_APB_DEC_ETFETB_LSR_ADDR A:0x60825fb4
y.create.l HWIO_QDSS_APB_DEC_ETFETB_AUTHSTATUS_ADDR A:0x60825fb8
y.create.l HWIO_QDSS_APB_DEC_ETFETB_DEVID_ADDR A:0x60825fc8
y.create.l HWIO_QDSS_APB_DEC_ETFETB_DEVTYPE_ADDR A:0x60825fcc
y.create.l HWIO_QDSS_APB_DEC_ETFETB_PERIPHID0_ADDR A:0x60825fe0
y.create.l HWIO_QDSS_APB_DEC_ETFETB_PERIPHID1_ADDR A:0x60825fe4
y.create.l HWIO_QDSS_APB_DEC_ETFETB_PERIPHID2_ADDR A:0x60825fe8
y.create.l HWIO_QDSS_APB_DEC_ETFETB_PERIPHID3_ADDR A:0x60825fec
y.create.l HWIO_QDSS_APB_DEC_ETFETB_PERIPHID4_ADDR A:0x60825fd0
y.create.l HWIO_QDSS_APB_DEC_ETFETB_PERIPHID5_ADDR A:0x60825fd4
y.create.l HWIO_QDSS_APB_DEC_ETFETB_PERIPHID6_ADDR A:0x60825fd8
y.create.l HWIO_QDSS_APB_DEC_ETFETB_PERIPHID7_ADDR A:0x60825fdc
y.create.l HWIO_QDSS_APB_DEC_ETFETB_COMPID0_ADDR A:0x60825ff0
y.create.l HWIO_QDSS_APB_DEC_ETFETB_COMPID1_ADDR A:0x60825ff4
y.create.l HWIO_QDSS_APB_DEC_ETFETB_COMPID2_ADDR A:0x60825ff8
y.create.l HWIO_QDSS_APB_DEC_ETFETB_COMPID3_ADDR A:0x60825ffc
y.create.l HWIO_QDSS_APB_DEC_ETR_RSZ_ADDR A:0x60826004
y.create.l HWIO_QDSS_APB_DEC_ETR_STS_ADDR A:0x6082600c
y.create.l HWIO_QDSS_APB_DEC_ETR_RRD_ADDR A:0x60826010
y.create.l HWIO_QDSS_APB_DEC_ETR_RRP_ADDR A:0x60826014
y.create.l HWIO_QDSS_APB_DEC_ETR_RWP_ADDR A:0x60826018
y.create.l HWIO_QDSS_APB_DEC_ETR_TRG_ADDR A:0x6082601c
y.create.l HWIO_QDSS_APB_DEC_ETR_CTL_ADDR A:0x60826020
y.create.l HWIO_QDSS_APB_DEC_ETR_RWD_ADDR A:0x60826024
y.create.l HWIO_QDSS_APB_DEC_ETR_MODE_ADDR A:0x60826028
y.create.l HWIO_QDSS_APB_DEC_ETR_LBUFLEVEL_ADDR A:0x6082602c
y.create.l HWIO_QDSS_APB_DEC_ETR_CBUFLEVEL_ADDR A:0x60826030
y.create.l HWIO_QDSS_APB_DEC_ETR_BUFWM_ADDR A:0x60826034
y.create.l HWIO_QDSS_APB_DEC_ETR_RRPHI_ADDR A:0x60826038
y.create.l HWIO_QDSS_APB_DEC_ETR_RWPHI_ADDR A:0x6082603c
y.create.l HWIO_QDSS_APB_DEC_ETR_AXICTL_ADDR A:0x60826110
y.create.l HWIO_QDSS_APB_DEC_ETR_DBALO_ADDR A:0x60826118
y.create.l HWIO_QDSS_APB_DEC_ETR_DBAHI_ADDR A:0x6082611c
y.create.l HWIO_QDSS_APB_DEC_ETR_FFSR_ADDR A:0x60826300
y.create.l HWIO_QDSS_APB_DEC_ETR_FFCR_ADDR A:0x60826304
y.create.l HWIO_QDSS_APB_DEC_ETR_PSCR_ADDR A:0x60826308
y.create.l HWIO_QDSS_APB_DEC_ETR_ITMISCOP0_ADDR A:0x60826ee0
y.create.l HWIO_QDSS_APB_DEC_ETR_ITTRFLIN_ADDR A:0x60826ee8
y.create.l HWIO_QDSS_APB_DEC_ETR_ITATBDATA0_ADDR A:0x60826eec
y.create.l HWIO_QDSS_APB_DEC_ETR_ITATBCTR2_ADDR A:0x60826ef0
y.create.l HWIO_QDSS_APB_DEC_ETR_ITATBCTR1_ADDR A:0x60826ef4
y.create.l HWIO_QDSS_APB_DEC_ETR_ITATBCTR0_ADDR A:0x60826ef8
y.create.l HWIO_QDSS_APB_DEC_ETR_ITCTRL_ADDR A:0x60826f00
y.create.l HWIO_QDSS_APB_DEC_ETR_CLAIMSET_ADDR A:0x60826fa0
y.create.l HWIO_QDSS_APB_DEC_ETR_CLAIMCLR_ADDR A:0x60826fa4
y.create.l HWIO_QDSS_APB_DEC_ETR_LAR_ADDR A:0x60826fb0
y.create.l HWIO_QDSS_APB_DEC_ETR_LSR_ADDR A:0x60826fb4
y.create.l HWIO_QDSS_APB_DEC_ETR_AUTHSTATUS_ADDR A:0x60826fb8
y.create.l HWIO_QDSS_APB_DEC_ETR_DEVID_ADDR A:0x60826fc8
y.create.l HWIO_QDSS_APB_DEC_ETR_DEVTYPE_ADDR A:0x60826fcc
y.create.l HWIO_QDSS_APB_DEC_ETR_PERIPHID0_ADDR A:0x60826fe0
y.create.l HWIO_QDSS_APB_DEC_ETR_PERIPHID1_ADDR A:0x60826fe4
y.create.l HWIO_QDSS_APB_DEC_ETR_PERIPHID2_ADDR A:0x60826fe8
y.create.l HWIO_QDSS_APB_DEC_ETR_PERIPHID3_ADDR A:0x60826fec
y.create.l HWIO_QDSS_APB_DEC_ETR_PERIPHID4_ADDR A:0x60826fd0
y.create.l HWIO_QDSS_APB_DEC_ETR_PERIPHID5_ADDR A:0x60826fd4
y.create.l HWIO_QDSS_APB_DEC_ETR_PERIPHID6_ADDR A:0x60826fd8
y.create.l HWIO_QDSS_APB_DEC_ETR_PERIPHID7_ADDR A:0x60826fdc
y.create.l HWIO_QDSS_APB_DEC_ETR_COMPID0_ADDR A:0x60826ff0
y.create.l HWIO_QDSS_APB_DEC_ETR_COMPID1_ADDR A:0x60826ff4
y.create.l HWIO_QDSS_APB_DEC_ETR_COMPID2_ADDR A:0x60826ff8
y.create.l HWIO_QDSS_APB_DEC_ETR_COMPID3_ADDR A:0x60826ffc
y.create.l HWIO_QDSS_WRAPPER_ATB_FUN2X1_CTRL_REG_ADDR A:0x60868000
y.create.l HWIO_QDSS_WRAPPER_ATB_FUN2X1_PRIORITY_CTRL_REG_ADDR A:0x60868004
y.create.l HWIO_QDSS_WRAPPER_ATB_FUN2X1_ITATBDATA0_ADDR A:0x60868eec
y.create.l HWIO_QDSS_WRAPPER_ATB_FUN2X1_ITATBCTR2_ADDR A:0x60868ef0
y.create.l HWIO_QDSS_WRAPPER_ATB_FUN2X1_ITATBCTR1_ADDR A:0x60868ef4
y.create.l HWIO_QDSS_WRAPPER_ATB_FUN2X1_ITATBCTR0_ADDR A:0x60868ef8
y.create.l HWIO_QDSS_WRAPPER_ATB_FUN2X1_ITCTRL_ADDR A:0x60868f00
y.create.l HWIO_QDSS_WRAPPER_ATB_FUN2X1_CLAIMSET_ADDR A:0x60868fa0
y.create.l HWIO_QDSS_WRAPPER_ATB_FUN2X1_CLAIMCLR_ADDR A:0x60868fa4
y.create.l HWIO_QDSS_WRAPPER_ATB_FUN2X1_LOCKACCESS_ADDR A:0x60868fb0
y.create.l HWIO_QDSS_WRAPPER_ATB_FUN2X1_LOCKSTATUS_ADDR A:0x60868fb4
y.create.l HWIO_QDSS_WRAPPER_ATB_FUN2X1_AUTHSTATUS_ADDR A:0x60868fb8
y.create.l HWIO_QDSS_WRAPPER_ATB_FUN2X1_DEVID_ADDR A:0x60868fc8
y.create.l HWIO_QDSS_WRAPPER_ATB_FUN2X1_DEVTYPE_ADDR A:0x60868fcc
y.create.l HWIO_QDSS_WRAPPER_ATB_FUN2X1_PERIPHID0_ADDR A:0x60868fe0
y.create.l HWIO_QDSS_WRAPPER_ATB_FUN2X1_PERIPHID1_ADDR A:0x60868fe4
y.create.l HWIO_QDSS_WRAPPER_ATB_FUN2X1_PERIPHID2_ADDR A:0x60868fe8
y.create.l HWIO_QDSS_WRAPPER_ATB_FUN2X1_PERIPHID3_ADDR A:0x60868fec
y.create.l HWIO_QDSS_WRAPPER_ATB_FUN2X1_PERIPHID4_ADDR A:0x60868fd0
y.create.l HWIO_QDSS_WRAPPER_ATB_FUN2X1_PERIPHID5_ADDR A:0x60868fd4
y.create.l HWIO_QDSS_WRAPPER_ATB_FUN2X1_PERIPHID6_ADDR A:0x60868fd8
y.create.l HWIO_QDSS_WRAPPER_ATB_FUN2X1_PERIPHID7_ADDR A:0x60868fdc
y.create.l HWIO_QDSS_WRAPPER_ATB_FUN2X1_COMPID0_ADDR A:0x60868ff0
y.create.l HWIO_QDSS_WRAPPER_ATB_FUN2X1_COMPID1_ADDR A:0x60868ff4
y.create.l HWIO_QDSS_WRAPPER_ATB_FUN2X1_COMPID2_ADDR A:0x60868ff8
y.create.l HWIO_QDSS_WRAPPER_ATB_FUN2X1_COMPID3_ADDR A:0x60868ffc
y.create.l HWIO_QDSS_WRAPPER_HWEVENT_EXPD_COL0_OEN_REG_ADDR A:0x6086c000
y.create.l HWIO_QDSS_WRAPPER_HWEVENT_EXPD_COL1_OEN_REG_ADDR A:0x6086c004
y.create.l HWIO_QDSS_WRAPPER_HWEVENT_EXPD_COL2_OEN_REG_ADDR A:0x6086c008
y.create.l HWIO_QDSS_WRAPPER_HWEVENT_EXPD_COL3_OEN_REG_ADDR A:0x6086c00c
y.create.l HWIO_QDSS_WRAPPER_HWEVENT_EXPD_COL4_OEN_REG_ADDR A:0x6086c010
y.create.l HWIO_QDSS_WRAPPER_HWEVENT_EXPD_COL5_OEN_REG_ADDR A:0x6086c014
y.create.l HWIO_QDSS_WRAPPER_HWEVENT_EXPD_COL6_OEN_REG_ADDR A:0x6086c018
y.create.l HWIO_QDSS_WRAPPER_HWEVENT_EXPD_COL7_OEN_REG_ADDR A:0x6086c01c
y.create.l HWIO_QDSS_WRAPPER_HWEVENT_EXPD_COL8_OEN_REG_ADDR A:0x6086c020
y.create.l HWIO_QDSS_WRAPPER_HWEVENT_EXPD_COL9_OEN_REG_ADDR A:0x6086c024
y.create.l HWIO_QDSS_WRAPPER_HWEVENT_EXPD_COL0_MUX_SEL0_REG_ADDR A:0x6086c040
y.create.l HWIO_QDSS_WRAPPER_HWEVENT_EXPD_COL1_MUX_SEL0_REG_ADDR A:0x6086c050
y.create.l HWIO_QDSS_WRAPPER_HWEVENT_EXPD_COL2_MUX_SEL0_REG_ADDR A:0x6086c060
y.create.l HWIO_QDSS_WRAPPER_HWEVENT_EXPD_COL3_MUX_SEL0_REG_ADDR A:0x6086c070
y.create.l HWIO_QDSS_WRAPPER_HWEVENT_EXPD_COL4_MUX_SEL0_REG_ADDR A:0x6086c080
y.create.l HWIO_QDSS_WRAPPER_HWEVENT_EXPD_COL5_MUX_SEL0_REG_ADDR A:0x6086c090
y.create.l HWIO_QDSS_WRAPPER_HWEVENT_EXPD_COL6_MUX_SEL0_REG_ADDR A:0x6086c0a0
y.create.l HWIO_QDSS_WRAPPER_HWEVENT_EXPD_COL7_MUX_SEL0_REG_ADDR A:0x6086c0b0
y.create.l HWIO_QDSS_WRAPPER_HWEVENT_EXPD_COL8_MUX_SEL0_REG_ADDR A:0x6086c0c0
y.create.l HWIO_QDSS_WRAPPER_HWEVENT_EXPD_COL9_MUX_SEL0_REG_ADDR A:0x6086c0d0
y.create.l HWIO_QDSS_WRAPPER_HWEVENT_EXPD_COL0_MUX_SEL1_REG_ADDR A:0x6086c044
y.create.l HWIO_QDSS_WRAPPER_HWEVENT_EXPD_COL1_MUX_SEL1_REG_ADDR A:0x6086c054
y.create.l HWIO_QDSS_WRAPPER_HWEVENT_EXPD_COL2_MUX_SEL1_REG_ADDR A:0x6086c064
y.create.l HWIO_QDSS_WRAPPER_HWEVENT_EXPD_COL3_MUX_SEL1_REG_ADDR A:0x6086c074
y.create.l HWIO_QDSS_WRAPPER_HWEVENT_EXPD_COL4_MUX_SEL1_REG_ADDR A:0x6086c084
y.create.l HWIO_QDSS_WRAPPER_HWEVENT_EXPD_COL5_MUX_SEL1_REG_ADDR A:0x6086c094
y.create.l HWIO_QDSS_WRAPPER_HWEVENT_EXPD_COL6_MUX_SEL1_REG_ADDR A:0x6086c0a4
y.create.l HWIO_QDSS_WRAPPER_HWEVENT_EXPD_COL7_MUX_SEL1_REG_ADDR A:0x6086c0b4
y.create.l HWIO_QDSS_WRAPPER_HWEVENT_EXPD_COL8_MUX_SEL1_REG_ADDR A:0x6086c0c4
y.create.l HWIO_QDSS_WRAPPER_HWEVENT_EXPD_COL9_MUX_SEL1_REG_ADDR A:0x6086c0d4
y.create.l HWIO_QDSS_WRAPPER_HWEVENT_EXPD_COL0_MUX_SEL2_REG_ADDR A:0x6086c048
y.create.l HWIO_QDSS_WRAPPER_HWEVENT_EXPD_COL1_MUX_SEL2_REG_ADDR A:0x6086c058
y.create.l HWIO_QDSS_WRAPPER_HWEVENT_EXPD_COL2_MUX_SEL2_REG_ADDR A:0x6086c068
y.create.l HWIO_QDSS_WRAPPER_HWEVENT_EXPD_COL3_MUX_SEL2_REG_ADDR A:0x6086c078
y.create.l HWIO_QDSS_WRAPPER_HWEVENT_EXPD_COL4_MUX_SEL2_REG_ADDR A:0x6086c088
y.create.l HWIO_QDSS_WRAPPER_HWEVENT_EXPD_COL5_MUX_SEL2_REG_ADDR A:0x6086c098
y.create.l HWIO_QDSS_WRAPPER_HWEVENT_EXPD_COL6_MUX_SEL2_REG_ADDR A:0x6086c0a8
y.create.l HWIO_QDSS_WRAPPER_HWEVENT_EXPD_COL7_MUX_SEL2_REG_ADDR A:0x6086c0b8
y.create.l HWIO_QDSS_WRAPPER_HWEVENT_EXPD_COL8_MUX_SEL2_REG_ADDR A:0x6086c0c8
y.create.l HWIO_QDSS_WRAPPER_HWEVENT_EXPD_COL9_MUX_SEL2_REG_ADDR A:0x6086c0d8
y.create.l HWIO_QDSS_WRAPPER_HWEVENT_EXPD_COL0_MUX_SEL3_REG_ADDR A:0x6086c04c
y.create.l HWIO_QDSS_WRAPPER_HWEVENT_EXPD_COL1_MUX_SEL3_REG_ADDR A:0x6086c05c
y.create.l HWIO_QDSS_WRAPPER_HWEVENT_EXPD_COL2_MUX_SEL3_REG_ADDR A:0x6086c06c
y.create.l HWIO_QDSS_WRAPPER_HWEVENT_EXPD_COL3_MUX_SEL3_REG_ADDR A:0x6086c07c
y.create.l HWIO_QDSS_WRAPPER_HWEVENT_EXPD_COL4_MUX_SEL3_REG_ADDR A:0x6086c08c
y.create.l HWIO_QDSS_WRAPPER_HWEVENT_EXPD_COL5_MUX_SEL3_REG_ADDR A:0x6086c09c
y.create.l HWIO_QDSS_WRAPPER_HWEVENT_EXPD_COL6_MUX_SEL3_REG_ADDR A:0x6086c0ac
y.create.l HWIO_QDSS_WRAPPER_HWEVENT_EXPD_COL7_MUX_SEL3_REG_ADDR A:0x6086c0bc
y.create.l HWIO_QDSS_WRAPPER_HWEVENT_EXPD_COL8_MUX_SEL3_REG_ADDR A:0x6086c0cc
y.create.l HWIO_QDSS_WRAPPER_HWEVENT_EXPD_COL9_MUX_SEL3_REG_ADDR A:0x6086c0dc
y.create.l HWIO_QDSS_WRAPPER_IRQ_MUX_REG_ADDR A:0x6086c140
y.create.l HWIO_QDSS_WRAPPER_HWE_SPDM_SPI_I2C_MUX_REG_ADDR A:0x6086c144
y.create.l HWIO_QDSS_WRAPPER_CS_HWE_EXPD_ITCTL_ADDR A:0x6086cf00
y.create.l HWIO_QDSS_WRAPPER_CS_HWE_EXPD_CLAIMSET_ADDR A:0x6086cfa0
y.create.l HWIO_QDSS_WRAPPER_CS_HWE_EXPD_CLAIMCLR_ADDR A:0x6086cfa4
y.create.l HWIO_QDSS_WRAPPER_CS_HWE_EXPD_LOCKACCESS_ADDR A:0x6086cfb0
y.create.l HWIO_QDSS_WRAPPER_CS_HWE_EXPD_LOCKSTATUS_ADDR A:0x6086cfb4
y.create.l HWIO_QDSS_WRAPPER_CS_HWE_EXPD_AUTHSTATUS_ADDR A:0x6086cfb8
y.create.l HWIO_QDSS_WRAPPER_CS_HWE_EXPD_DEVICEID_ADDR A:0x6086cfc8
y.create.l HWIO_QDSS_WRAPPER_CS_HWE_EXPD_DEVICETYPE_ADDR A:0x6086cfcc
y.create.l HWIO_QDSS_WRAPPER_CS_HWE_EXPD_PERIPHID4_ADDR A:0x6086cfd0
y.create.l HWIO_QDSS_WRAPPER_CS_HWE_EXPD_PERIPHID5_ADDR A:0x6086cfd4
y.create.l HWIO_QDSS_WRAPPER_CS_HWE_EXPD_PERIPHID6_ADDR A:0x6086cfd8
y.create.l HWIO_QDSS_WRAPPER_CS_HWE_EXPD_PERIPHID7_ADDR A:0x6086cfdc
y.create.l HWIO_QDSS_WRAPPER_CS_HWE_EXPD_PERIPHID0_ADDR A:0x6086cfe0
y.create.l HWIO_QDSS_WRAPPER_CS_HWE_EXPD_PERIPHID1_ADDR A:0x6086cfe4
y.create.l HWIO_QDSS_WRAPPER_CS_HWE_EXPD_PERIPHID2_ADDR A:0x6086cfe8
y.create.l HWIO_QDSS_WRAPPER_CS_HWE_EXPD_PERIPHID3_ADDR A:0x6086cfec
y.create.l HWIO_QDSS_WRAPPER_CS_HWE_EXPD_COMPID0_ADDR A:0x6086cff0
y.create.l HWIO_QDSS_WRAPPER_CS_HWE_EXPD_COMPID1_ADDR A:0x6086cff4
y.create.l HWIO_QDSS_WRAPPER_CS_HWE_EXPD_COMPID2_ADDR A:0x6086cff8
y.create.l HWIO_QDSS_WRAPPER_CS_HWE_EXPD_COMPID3_ADDR A:0x6086cffc
y.create.l HWIO_QDSS_WRAPPER_DEBUG_UI_SECURE_ADDR A:0x6086d000
y.create.l HWIO_QDSS_WRAPPER_DEBUG_UI_CTL_ADDR A:0x6086d004
y.create.l HWIO_QDSS_WRAPPER_DEBUG_UI_CTL_MASK_ADDR A:0x6086d008
y.create.l HWIO_QDSS_WRAPPER_DEBUG_UI_SWTRIG_ADDR A:0x6086d00c
y.create.l HWIO_QDSS_WRAPPER_DEBUG_UI_STATUS_ADDR A:0x6086d010
y.create.l HWIO_QDSS_WRAPPER_DEBUG_UI_HWE_MASK_ADDR A:0x6086d014
y.create.l HWIO_QDSS_WRAPPER_DEBUG_UI_CTR_VAL_ADDR A:0x6086d018
y.create.l HWIO_QDSS_WRAPPER_DEBUG_UI_CTR_EN_ADDR A:0x6086d01c
y.create.l HWIO_QDSS_WRAPPER_DEBUG_UI_NUM_REGS_RD_ADDR A:0x6086d020
y.create.l HWIO_QDSS_WRAPPER_DEBUG_UI_ATB_REG_ADDR A:0x6086d024
y.create.l HWIO_QDSS_WRAPPER_DEBUG_UI_ADDR_0_ADDR A:0x6086d030
y.create.l HWIO_QDSS_WRAPPER_DEBUG_UI_ADDR_1_ADDR A:0x6086d034
y.create.l HWIO_QDSS_WRAPPER_DEBUG_UI_ADDR_2_ADDR A:0x6086d038
y.create.l HWIO_QDSS_WRAPPER_DEBUG_UI_ADDR_3_ADDR A:0x6086d03c
y.create.l HWIO_QDSS_WRAPPER_DEBUG_UI_ADDR_4_ADDR A:0x6086d040
y.create.l HWIO_QDSS_WRAPPER_DEBUG_UI_ADDR_5_ADDR A:0x6086d044
y.create.l HWIO_QDSS_WRAPPER_DEBUG_UI_ADDR_6_ADDR A:0x6086d048
y.create.l HWIO_QDSS_WRAPPER_DEBUG_UI_ADDR_7_ADDR A:0x6086d04c
y.create.l HWIO_QDSS_WRAPPER_DEBUG_UI_ADDR_8_ADDR A:0x6086d050
y.create.l HWIO_QDSS_WRAPPER_DEBUG_UI_ADDR_9_ADDR A:0x6086d054
y.create.l HWIO_QDSS_WRAPPER_DEBUG_UI_ADDR_10_ADDR A:0x6086d058
y.create.l HWIO_QDSS_WRAPPER_DEBUG_UI_ADDR_11_ADDR A:0x6086d05c
y.create.l HWIO_QDSS_WRAPPER_DEBUG_UI_ADDR_12_ADDR A:0x6086d060
y.create.l HWIO_QDSS_WRAPPER_DEBUG_UI_DATA_0_ADDR A:0x6086d0b0
y.create.l HWIO_QDSS_WRAPPER_DEBUG_UI_DATA_1_ADDR A:0x6086d0b4
y.create.l HWIO_QDSS_WRAPPER_DEBUG_UI_DATA_2_ADDR A:0x6086d0b8
y.create.l HWIO_QDSS_WRAPPER_DEBUG_UI_DATA_3_ADDR A:0x6086d0bc
y.create.l HWIO_QDSS_WRAPPER_DEBUG_UI_DATA_4_ADDR A:0x6086d0c0
y.create.l HWIO_QDSS_WRAPPER_DEBUG_UI_DATA_5_ADDR A:0x6086d0c4
y.create.l HWIO_QDSS_WRAPPER_DEBUG_UI_DATA_6_ADDR A:0x6086d0c8
y.create.l HWIO_QDSS_WRAPPER_DEBUG_UI_DATA_7_ADDR A:0x6086d0cc
y.create.l HWIO_QDSS_WRAPPER_DEBUG_UI_DATA_8_ADDR A:0x6086d0d0
y.create.l HWIO_QDSS_WRAPPER_DEBUG_UI_DATA_9_ADDR A:0x6086d0d4
y.create.l HWIO_QDSS_WRAPPER_CS_DEBUG_UI_ITCTL_ADDR A:0x6086df00
y.create.l HWIO_QDSS_WRAPPER_CS_DEBUG_UI_CLAIMSET_ADDR A:0x6086dfa0
y.create.l HWIO_QDSS_WRAPPER_CS_DEBUG_UI_CLAIMCLR_ADDR A:0x6086dfa4
y.create.l HWIO_QDSS_WRAPPER_CS_DEBUG_UI_LOCKACCESS_ADDR A:0x6086dfb0
y.create.l HWIO_QDSS_WRAPPER_CS_DEBUG_UI_LOCKSTATUS_ADDR A:0x6086dfb4
y.create.l HWIO_QDSS_WRAPPER_CS_DEBUG_UI_AUTHSTATUS_ADDR A:0x6086dfb8
y.create.l HWIO_QDSS_WRAPPER_CS_DEBUG_UI_DEVICEID_ADDR A:0x6086dfc8
y.create.l HWIO_QDSS_WRAPPER_CS_DEBUG_UI_DEVICETYPE_ADDR A:0x6086dfcc
y.create.l HWIO_QDSS_WRAPPER_CS_DEBUG_UI_PERIPHID4_ADDR A:0x6086dfd0
y.create.l HWIO_QDSS_WRAPPER_CS_DEBUG_UI_PERIPHID5_ADDR A:0x6086dfd4
y.create.l HWIO_QDSS_WRAPPER_CS_DEBUG_UI_PERIPHID6_ADDR A:0x6086dfd8
y.create.l HWIO_QDSS_WRAPPER_CS_DEBUG_UI_PERIPHID7_ADDR A:0x6086dfdc
y.create.l HWIO_QDSS_WRAPPER_CS_DEBUG_UI_PERIPHID0_ADDR A:0x6086dfe0
y.create.l HWIO_QDSS_WRAPPER_CS_DEBUG_UI_PERIPHID1_ADDR A:0x6086dfe4
y.create.l HWIO_QDSS_WRAPPER_CS_DEBUG_UI_PERIPHID2_ADDR A:0x6086dfe8
y.create.l HWIO_QDSS_WRAPPER_CS_DEBUG_UI_PERIPHID3_ADDR A:0x6086dfec
y.create.l HWIO_QDSS_WRAPPER_CS_DEBUG_UI_COMPID0_ADDR A:0x6086dff0
y.create.l HWIO_QDSS_WRAPPER_CS_DEBUG_UI_COMPID1_ADDR A:0x6086dff4
y.create.l HWIO_QDSS_WRAPPER_CS_DEBUG_UI_COMPID2_ADDR A:0x6086dff8
y.create.l HWIO_QDSS_WRAPPER_CS_DEBUG_UI_COMPID3_ADDR A:0x6086dffc
y.create.l HWIO_QPIC_QPIC_BAM_CTRL_ADDR A:0x67984000
y.create.l HWIO_QPIC_QPIC_BAM_TIMER_ADDR A:0x67984040
y.create.l HWIO_QPIC_QPIC_BAM_TIMER_CTRL_ADDR A:0x67984044
y.create.l HWIO_QPIC_QPIC_BAM_DESC_CNT_TRSHLD_ADDR A:0x67984008
y.create.l HWIO_QPIC_QPIC_BAM_IRQ_STTS_ADDR A:0x67984014
y.create.l HWIO_QPIC_QPIC_BAM_IRQ_CLR_ADDR A:0x67984018
y.create.l HWIO_QPIC_QPIC_BAM_IRQ_EN_ADDR A:0x6798401c
y.create.l HWIO_QPIC_QPIC_BAM_CNFG_BITS_ADDR A:0x6798407c
y.create.l HWIO_QPIC_QPIC_BAM_CNFG_BITS_2_ADDR A:0x67984084
y.create.l HWIO_QPIC_QPIC_BAM_REVISION_ADDR A:0x67985000
y.create.l HWIO_QPIC_QPIC_BAM_SW_VERSION_ADDR A:0x67985004
y.create.l HWIO_QPIC_QPIC_BAM_NUM_PIPES_ADDR A:0x67985008
y.create.l HWIO_QPIC_QPIC_BAM_TEST_BUS_SEL_ADDR A:0x67985010
y.create.l HWIO_QPIC_QPIC_BAM_TEST_BUS_REG_ADDR A:0x67985014
y.create.l HWIO_QPIC_QPIC_BAM_AHB_MASTER_ERR_CTRLS_ADDR A:0x67985024
y.create.l HWIO_QPIC_QPIC_BAM_AHB_MASTER_ERR_ADDR_ADDR A:0x67985028
y.create.l HWIO_QPIC_QPIC_BAM_AHB_MASTER_ERR_DATA_ADDR A:0x6798502c
y.create.l HWIO_QPIC_QPIC_BAM_AHB_MASTER_ERR_ADDR_LSB_ADDR A:0x67985100
y.create.l HWIO_QPIC_QPIC_BAM_AHB_MASTER_ERR_ADDR_MSB_ADDR A:0x67985104
y.create.l HWIO_QPIC_QPIC_BAM_TRUST_REG_ADDR A:0x67986000
y.create.l HWIO_QPIC_QPIC_BAM_P_TRUST_REG0_ADDR A:0x67986020
y.create.l HWIO_QPIC_QPIC_BAM_P_TRUST_REG1_ADDR A:0x67986024
y.create.l HWIO_QPIC_QPIC_BAM_P_TRUST_REG2_ADDR A:0x67986028
y.create.l HWIO_QPIC_QPIC_BAM_P_TRUST_REG3_ADDR A:0x6798602c
y.create.l HWIO_QPIC_QPIC_BAM_P_TRUST_REG4_ADDR A:0x67986030
y.create.l HWIO_QPIC_QPIC_BAM_P_TRUST_REG5_ADDR A:0x67986034
y.create.l HWIO_QPIC_QPIC_BAM_P_TRUST_REG6_ADDR A:0x67986038
y.create.l HWIO_QPIC_QPIC_BAM_IRQ_SRCS_EE0_ADDR A:0x67987000
y.create.l HWIO_QPIC_QPIC_BAM_IRQ_SRCS_EE1_ADDR A:0x67988000
y.create.l HWIO_QPIC_QPIC_BAM_IRQ_SRCS_EE2_ADDR A:0x67989000
y.create.l HWIO_QPIC_QPIC_BAM_IRQ_SRCS_EE3_ADDR A:0x6798a000
y.create.l HWIO_QPIC_QPIC_BAM_IRQ_SRCS_EE4_ADDR A:0x6798b000
y.create.l HWIO_QPIC_QPIC_BAM_IRQ_SRCS_EE5_ADDR A:0x6798c000
y.create.l HWIO_QPIC_QPIC_BAM_IRQ_SRCS_EE6_ADDR A:0x6798d000
y.create.l HWIO_QPIC_QPIC_BAM_IRQ_SRCS_EE7_ADDR A:0x6798e000
y.create.l HWIO_QPIC_QPIC_BAM_IRQ_SRCS_MSK_EE0_ADDR A:0x67987004
y.create.l HWIO_QPIC_QPIC_BAM_IRQ_SRCS_MSK_EE1_ADDR A:0x67988004
y.create.l HWIO_QPIC_QPIC_BAM_IRQ_SRCS_MSK_EE2_ADDR A:0x67989004
y.create.l HWIO_QPIC_QPIC_BAM_IRQ_SRCS_MSK_EE3_ADDR A:0x6798a004
y.create.l HWIO_QPIC_QPIC_BAM_IRQ_SRCS_MSK_EE4_ADDR A:0x6798b004
y.create.l HWIO_QPIC_QPIC_BAM_IRQ_SRCS_MSK_EE5_ADDR A:0x6798c004
y.create.l HWIO_QPIC_QPIC_BAM_IRQ_SRCS_MSK_EE6_ADDR A:0x6798d004
y.create.l HWIO_QPIC_QPIC_BAM_IRQ_SRCS_MSK_EE7_ADDR A:0x6798e004
y.create.l HWIO_QPIC_QPIC_BAM_IRQ_SRCS_UNMASKED_EE0_ADDR A:0x67987008
y.create.l HWIO_QPIC_QPIC_BAM_IRQ_SRCS_UNMASKED_EE1_ADDR A:0x67988008
y.create.l HWIO_QPIC_QPIC_BAM_IRQ_SRCS_UNMASKED_EE2_ADDR A:0x67989008
y.create.l HWIO_QPIC_QPIC_BAM_IRQ_SRCS_UNMASKED_EE3_ADDR A:0x6798a008
y.create.l HWIO_QPIC_QPIC_BAM_IRQ_SRCS_UNMASKED_EE4_ADDR A:0x6798b008
y.create.l HWIO_QPIC_QPIC_BAM_IRQ_SRCS_UNMASKED_EE5_ADDR A:0x6798c008
y.create.l HWIO_QPIC_QPIC_BAM_IRQ_SRCS_UNMASKED_EE6_ADDR A:0x6798d008
y.create.l HWIO_QPIC_QPIC_BAM_IRQ_SRCS_UNMASKED_EE7_ADDR A:0x6798e008
y.create.l HWIO_QPIC_QPIC_BAM_PIPE_ATTR_EE0_ADDR A:0x6798700c
y.create.l HWIO_QPIC_QPIC_BAM_PIPE_ATTR_EE1_ADDR A:0x6798800c
y.create.l HWIO_QPIC_QPIC_BAM_PIPE_ATTR_EE2_ADDR A:0x6798900c
y.create.l HWIO_QPIC_QPIC_BAM_PIPE_ATTR_EE3_ADDR A:0x6798a00c
y.create.l HWIO_QPIC_QPIC_BAM_PIPE_ATTR_EE4_ADDR A:0x6798b00c
y.create.l HWIO_QPIC_QPIC_BAM_PIPE_ATTR_EE5_ADDR A:0x6798c00c
y.create.l HWIO_QPIC_QPIC_BAM_PIPE_ATTR_EE6_ADDR A:0x6798d00c
y.create.l HWIO_QPIC_QPIC_BAM_PIPE_ATTR_EE7_ADDR A:0x6798e00c
y.create.l HWIO_QPIC_QPIC_BAM_IRQ_SRCS_ADDR A:0x67987010
y.create.l HWIO_QPIC_QPIC_BAM_IRQ_SRCS_MSK_ADDR A:0x67987014
y.create.l HWIO_QPIC_QPIC_BAM_IRQ_SRCS_UNMASKED_ADDR A:0x67987018
y.create.l HWIO_QPIC_QPIC_BAM_P_CTRL0_ADDR A:0x67997000
y.create.l HWIO_QPIC_QPIC_BAM_P_CTRL1_ADDR A:0x67998000
y.create.l HWIO_QPIC_QPIC_BAM_P_CTRL2_ADDR A:0x67999000
y.create.l HWIO_QPIC_QPIC_BAM_P_CTRL3_ADDR A:0x6799a000
y.create.l HWIO_QPIC_QPIC_BAM_P_CTRL4_ADDR A:0x6799b000
y.create.l HWIO_QPIC_QPIC_BAM_P_CTRL5_ADDR A:0x6799c000
y.create.l HWIO_QPIC_QPIC_BAM_P_CTRL6_ADDR A:0x6799d000
y.create.l HWIO_QPIC_QPIC_BAM_P_RST0_ADDR A:0x67997004
y.create.l HWIO_QPIC_QPIC_BAM_P_RST1_ADDR A:0x67998004
y.create.l HWIO_QPIC_QPIC_BAM_P_RST2_ADDR A:0x67999004
y.create.l HWIO_QPIC_QPIC_BAM_P_RST3_ADDR A:0x6799a004
y.create.l HWIO_QPIC_QPIC_BAM_P_RST4_ADDR A:0x6799b004
y.create.l HWIO_QPIC_QPIC_BAM_P_RST5_ADDR A:0x6799c004
y.create.l HWIO_QPIC_QPIC_BAM_P_RST6_ADDR A:0x6799d004
y.create.l HWIO_QPIC_QPIC_BAM_P_HALT0_ADDR A:0x67997008
y.create.l HWIO_QPIC_QPIC_BAM_P_HALT1_ADDR A:0x67998008
y.create.l HWIO_QPIC_QPIC_BAM_P_HALT2_ADDR A:0x67999008
y.create.l HWIO_QPIC_QPIC_BAM_P_HALT3_ADDR A:0x6799a008
y.create.l HWIO_QPIC_QPIC_BAM_P_HALT4_ADDR A:0x6799b008
y.create.l HWIO_QPIC_QPIC_BAM_P_HALT5_ADDR A:0x6799c008
y.create.l HWIO_QPIC_QPIC_BAM_P_HALT6_ADDR A:0x6799d008
y.create.l HWIO_QPIC_QPIC_BAM_P_IRQ_STTS0_ADDR A:0x67997010
y.create.l HWIO_QPIC_QPIC_BAM_P_IRQ_STTS1_ADDR A:0x67998010
y.create.l HWIO_QPIC_QPIC_BAM_P_IRQ_STTS2_ADDR A:0x67999010
y.create.l HWIO_QPIC_QPIC_BAM_P_IRQ_STTS3_ADDR A:0x6799a010
y.create.l HWIO_QPIC_QPIC_BAM_P_IRQ_STTS4_ADDR A:0x6799b010
y.create.l HWIO_QPIC_QPIC_BAM_P_IRQ_STTS5_ADDR A:0x6799c010
y.create.l HWIO_QPIC_QPIC_BAM_P_IRQ_STTS6_ADDR A:0x6799d010
y.create.l HWIO_QPIC_QPIC_BAM_P_IRQ_CLR0_ADDR A:0x67997014
y.create.l HWIO_QPIC_QPIC_BAM_P_IRQ_CLR1_ADDR A:0x67998014
y.create.l HWIO_QPIC_QPIC_BAM_P_IRQ_CLR2_ADDR A:0x67999014
y.create.l HWIO_QPIC_QPIC_BAM_P_IRQ_CLR3_ADDR A:0x6799a014
y.create.l HWIO_QPIC_QPIC_BAM_P_IRQ_CLR4_ADDR A:0x6799b014
y.create.l HWIO_QPIC_QPIC_BAM_P_IRQ_CLR5_ADDR A:0x6799c014
y.create.l HWIO_QPIC_QPIC_BAM_P_IRQ_CLR6_ADDR A:0x6799d014
y.create.l HWIO_QPIC_QPIC_BAM_P_IRQ_EN0_ADDR A:0x67997018
y.create.l HWIO_QPIC_QPIC_BAM_P_IRQ_EN1_ADDR A:0x67998018
y.create.l HWIO_QPIC_QPIC_BAM_P_IRQ_EN2_ADDR A:0x67999018
y.create.l HWIO_QPIC_QPIC_BAM_P_IRQ_EN3_ADDR A:0x6799a018
y.create.l HWIO_QPIC_QPIC_BAM_P_IRQ_EN4_ADDR A:0x6799b018
y.create.l HWIO_QPIC_QPIC_BAM_P_IRQ_EN5_ADDR A:0x6799c018
y.create.l HWIO_QPIC_QPIC_BAM_P_IRQ_EN6_ADDR A:0x6799d018
y.create.l HWIO_QPIC_QPIC_BAM_P_TIMER0_ADDR A:0x6799701c
y.create.l HWIO_QPIC_QPIC_BAM_P_TIMER1_ADDR A:0x6799801c
y.create.l HWIO_QPIC_QPIC_BAM_P_TIMER2_ADDR A:0x6799901c
y.create.l HWIO_QPIC_QPIC_BAM_P_TIMER3_ADDR A:0x6799a01c
y.create.l HWIO_QPIC_QPIC_BAM_P_TIMER4_ADDR A:0x6799b01c
y.create.l HWIO_QPIC_QPIC_BAM_P_TIMER5_ADDR A:0x6799c01c
y.create.l HWIO_QPIC_QPIC_BAM_P_TIMER6_ADDR A:0x6799d01c
y.create.l HWIO_QPIC_QPIC_BAM_P_TIMER_CTRL0_ADDR A:0x67997020
y.create.l HWIO_QPIC_QPIC_BAM_P_TIMER_CTRL1_ADDR A:0x67998020
y.create.l HWIO_QPIC_QPIC_BAM_P_TIMER_CTRL2_ADDR A:0x67999020
y.create.l HWIO_QPIC_QPIC_BAM_P_TIMER_CTRL3_ADDR A:0x6799a020
y.create.l HWIO_QPIC_QPIC_BAM_P_TIMER_CTRL4_ADDR A:0x6799b020
y.create.l HWIO_QPIC_QPIC_BAM_P_TIMER_CTRL5_ADDR A:0x6799c020
y.create.l HWIO_QPIC_QPIC_BAM_P_TIMER_CTRL6_ADDR A:0x6799d020
y.create.l HWIO_QPIC_QPIC_BAM_P_PRDCR_SDBND0_ADDR A:0x67997024
y.create.l HWIO_QPIC_QPIC_BAM_P_PRDCR_SDBND1_ADDR A:0x67998024
y.create.l HWIO_QPIC_QPIC_BAM_P_PRDCR_SDBND2_ADDR A:0x67999024
y.create.l HWIO_QPIC_QPIC_BAM_P_PRDCR_SDBND3_ADDR A:0x6799a024
y.create.l HWIO_QPIC_QPIC_BAM_P_PRDCR_SDBND4_ADDR A:0x6799b024
y.create.l HWIO_QPIC_QPIC_BAM_P_PRDCR_SDBND5_ADDR A:0x6799c024
y.create.l HWIO_QPIC_QPIC_BAM_P_PRDCR_SDBND6_ADDR A:0x6799d024
y.create.l HWIO_QPIC_QPIC_BAM_P_CNSMR_SDBND0_ADDR A:0x67997028
y.create.l HWIO_QPIC_QPIC_BAM_P_CNSMR_SDBND1_ADDR A:0x67998028
y.create.l HWIO_QPIC_QPIC_BAM_P_CNSMR_SDBND2_ADDR A:0x67999028
y.create.l HWIO_QPIC_QPIC_BAM_P_CNSMR_SDBND3_ADDR A:0x6799a028
y.create.l HWIO_QPIC_QPIC_BAM_P_CNSMR_SDBND4_ADDR A:0x6799b028
y.create.l HWIO_QPIC_QPIC_BAM_P_CNSMR_SDBND5_ADDR A:0x6799c028
y.create.l HWIO_QPIC_QPIC_BAM_P_CNSMR_SDBND6_ADDR A:0x6799d028
y.create.l HWIO_QPIC_QPIC_BAM_P_SW_OFSTS0_ADDR A:0x67997800
y.create.l HWIO_QPIC_QPIC_BAM_P_SW_OFSTS1_ADDR A:0x67998800
y.create.l HWIO_QPIC_QPIC_BAM_P_SW_OFSTS2_ADDR A:0x67999800
y.create.l HWIO_QPIC_QPIC_BAM_P_SW_OFSTS3_ADDR A:0x6799a800
y.create.l HWIO_QPIC_QPIC_BAM_P_SW_OFSTS4_ADDR A:0x6799b800
y.create.l HWIO_QPIC_QPIC_BAM_P_SW_OFSTS5_ADDR A:0x6799c800
y.create.l HWIO_QPIC_QPIC_BAM_P_SW_OFSTS6_ADDR A:0x6799d800
y.create.l HWIO_QPIC_QPIC_BAM_P_AU_PSM_CNTXT_1_0_ADDR A:0x67997804
y.create.l HWIO_QPIC_QPIC_BAM_P_AU_PSM_CNTXT_1_1_ADDR A:0x67998804
y.create.l HWIO_QPIC_QPIC_BAM_P_AU_PSM_CNTXT_1_2_ADDR A:0x67999804
y.create.l HWIO_QPIC_QPIC_BAM_P_AU_PSM_CNTXT_1_3_ADDR A:0x6799a804
y.create.l HWIO_QPIC_QPIC_BAM_P_AU_PSM_CNTXT_1_4_ADDR A:0x6799b804
y.create.l HWIO_QPIC_QPIC_BAM_P_AU_PSM_CNTXT_1_5_ADDR A:0x6799c804
y.create.l HWIO_QPIC_QPIC_BAM_P_AU_PSM_CNTXT_1_6_ADDR A:0x6799d804
y.create.l HWIO_QPIC_QPIC_BAM_P_PSM_CNTXT_2_0_ADDR A:0x67997808
y.create.l HWIO_QPIC_QPIC_BAM_P_PSM_CNTXT_2_1_ADDR A:0x67998808
y.create.l HWIO_QPIC_QPIC_BAM_P_PSM_CNTXT_2_2_ADDR A:0x67999808
y.create.l HWIO_QPIC_QPIC_BAM_P_PSM_CNTXT_2_3_ADDR A:0x6799a808
y.create.l HWIO_QPIC_QPIC_BAM_P_PSM_CNTXT_2_4_ADDR A:0x6799b808
y.create.l HWIO_QPIC_QPIC_BAM_P_PSM_CNTXT_2_5_ADDR A:0x6799c808
y.create.l HWIO_QPIC_QPIC_BAM_P_PSM_CNTXT_2_6_ADDR A:0x6799d808
y.create.l HWIO_QPIC_QPIC_BAM_P_PSM_CNTXT_3_0_ADDR A:0x6799780c
y.create.l HWIO_QPIC_QPIC_BAM_P_PSM_CNTXT_3_1_ADDR A:0x6799880c
y.create.l HWIO_QPIC_QPIC_BAM_P_PSM_CNTXT_3_2_ADDR A:0x6799980c
y.create.l HWIO_QPIC_QPIC_BAM_P_PSM_CNTXT_3_3_ADDR A:0x6799a80c
y.create.l HWIO_QPIC_QPIC_BAM_P_PSM_CNTXT_3_4_ADDR A:0x6799b80c
y.create.l HWIO_QPIC_QPIC_BAM_P_PSM_CNTXT_3_5_ADDR A:0x6799c80c
y.create.l HWIO_QPIC_QPIC_BAM_P_PSM_CNTXT_3_6_ADDR A:0x6799d80c
y.create.l HWIO_QPIC_QPIC_BAM_P_PSM_CNTXT_4_0_ADDR A:0x67997810
y.create.l HWIO_QPIC_QPIC_BAM_P_PSM_CNTXT_4_1_ADDR A:0x67998810
y.create.l HWIO_QPIC_QPIC_BAM_P_PSM_CNTXT_4_2_ADDR A:0x67999810
y.create.l HWIO_QPIC_QPIC_BAM_P_PSM_CNTXT_4_3_ADDR A:0x6799a810
y.create.l HWIO_QPIC_QPIC_BAM_P_PSM_CNTXT_4_4_ADDR A:0x6799b810
y.create.l HWIO_QPIC_QPIC_BAM_P_PSM_CNTXT_4_5_ADDR A:0x6799c810
y.create.l HWIO_QPIC_QPIC_BAM_P_PSM_CNTXT_4_6_ADDR A:0x6799d810
y.create.l HWIO_QPIC_QPIC_BAM_P_PSM_CNTXT_5_0_ADDR A:0x67997814
y.create.l HWIO_QPIC_QPIC_BAM_P_PSM_CNTXT_5_1_ADDR A:0x67998814
y.create.l HWIO_QPIC_QPIC_BAM_P_PSM_CNTXT_5_2_ADDR A:0x67999814
y.create.l HWIO_QPIC_QPIC_BAM_P_PSM_CNTXT_5_3_ADDR A:0x6799a814
y.create.l HWIO_QPIC_QPIC_BAM_P_PSM_CNTXT_5_4_ADDR A:0x6799b814
y.create.l HWIO_QPIC_QPIC_BAM_P_PSM_CNTXT_5_5_ADDR A:0x6799c814
y.create.l HWIO_QPIC_QPIC_BAM_P_PSM_CNTXT_5_6_ADDR A:0x6799d814
y.create.l HWIO_QPIC_QPIC_BAM_P_EVNT_REG0_ADDR A:0x67997818
y.create.l HWIO_QPIC_QPIC_BAM_P_EVNT_REG1_ADDR A:0x67998818
y.create.l HWIO_QPIC_QPIC_BAM_P_EVNT_REG2_ADDR A:0x67999818
y.create.l HWIO_QPIC_QPIC_BAM_P_EVNT_REG3_ADDR A:0x6799a818
y.create.l HWIO_QPIC_QPIC_BAM_P_EVNT_REG4_ADDR A:0x6799b818
y.create.l HWIO_QPIC_QPIC_BAM_P_EVNT_REG5_ADDR A:0x6799c818
y.create.l HWIO_QPIC_QPIC_BAM_P_EVNT_REG6_ADDR A:0x6799d818
y.create.l HWIO_QPIC_QPIC_BAM_P_DESC_FIFO_ADDR0_ADDR A:0x6799781c
y.create.l HWIO_QPIC_QPIC_BAM_P_DESC_FIFO_ADDR1_ADDR A:0x6799881c
y.create.l HWIO_QPIC_QPIC_BAM_P_DESC_FIFO_ADDR2_ADDR A:0x6799981c
y.create.l HWIO_QPIC_QPIC_BAM_P_DESC_FIFO_ADDR3_ADDR A:0x6799a81c
y.create.l HWIO_QPIC_QPIC_BAM_P_DESC_FIFO_ADDR4_ADDR A:0x6799b81c
y.create.l HWIO_QPIC_QPIC_BAM_P_DESC_FIFO_ADDR5_ADDR A:0x6799c81c
y.create.l HWIO_QPIC_QPIC_BAM_P_DESC_FIFO_ADDR6_ADDR A:0x6799d81c
y.create.l HWIO_QPIC_QPIC_BAM_P_FIFO_SIZES0_ADDR A:0x67997820
y.create.l HWIO_QPIC_QPIC_BAM_P_FIFO_SIZES1_ADDR A:0x67998820
y.create.l HWIO_QPIC_QPIC_BAM_P_FIFO_SIZES2_ADDR A:0x67999820
y.create.l HWIO_QPIC_QPIC_BAM_P_FIFO_SIZES3_ADDR A:0x6799a820
y.create.l HWIO_QPIC_QPIC_BAM_P_FIFO_SIZES4_ADDR A:0x6799b820
y.create.l HWIO_QPIC_QPIC_BAM_P_FIFO_SIZES5_ADDR A:0x6799c820
y.create.l HWIO_QPIC_QPIC_BAM_P_FIFO_SIZES6_ADDR A:0x6799d820
y.create.l HWIO_QPIC_QPIC_BAM_P_DATA_FIFO_ADDR0_ADDR A:0x67997824
y.create.l HWIO_QPIC_QPIC_BAM_P_DATA_FIFO_ADDR1_ADDR A:0x67998824
y.create.l HWIO_QPIC_QPIC_BAM_P_DATA_FIFO_ADDR2_ADDR A:0x67999824
y.create.l HWIO_QPIC_QPIC_BAM_P_DATA_FIFO_ADDR3_ADDR A:0x6799a824
y.create.l HWIO_QPIC_QPIC_BAM_P_DATA_FIFO_ADDR4_ADDR A:0x6799b824
y.create.l HWIO_QPIC_QPIC_BAM_P_DATA_FIFO_ADDR5_ADDR A:0x6799c824
y.create.l HWIO_QPIC_QPIC_BAM_P_DATA_FIFO_ADDR6_ADDR A:0x6799d824
y.create.l HWIO_QPIC_QPIC_BAM_P_EVNT_GEN_TRSHLD0_ADDR A:0x67997828
y.create.l HWIO_QPIC_QPIC_BAM_P_EVNT_GEN_TRSHLD1_ADDR A:0x67998828
y.create.l HWIO_QPIC_QPIC_BAM_P_EVNT_GEN_TRSHLD2_ADDR A:0x67999828
y.create.l HWIO_QPIC_QPIC_BAM_P_EVNT_GEN_TRSHLD3_ADDR A:0x6799a828
y.create.l HWIO_QPIC_QPIC_BAM_P_EVNT_GEN_TRSHLD4_ADDR A:0x6799b828
y.create.l HWIO_QPIC_QPIC_BAM_P_EVNT_GEN_TRSHLD5_ADDR A:0x6799c828
y.create.l HWIO_QPIC_QPIC_BAM_P_EVNT_GEN_TRSHLD6_ADDR A:0x6799d828
y.create.l HWIO_QPIC_QPIC_BAM_P_EVNT_DEST_ADDR0_ADDR A:0x6799782c
y.create.l HWIO_QPIC_QPIC_BAM_P_EVNT_DEST_ADDR1_ADDR A:0x6799882c
y.create.l HWIO_QPIC_QPIC_BAM_P_EVNT_DEST_ADDR2_ADDR A:0x6799982c
y.create.l HWIO_QPIC_QPIC_BAM_P_EVNT_DEST_ADDR3_ADDR A:0x6799a82c
y.create.l HWIO_QPIC_QPIC_BAM_P_EVNT_DEST_ADDR4_ADDR A:0x6799b82c
y.create.l HWIO_QPIC_QPIC_BAM_P_EVNT_DEST_ADDR5_ADDR A:0x6799c82c
y.create.l HWIO_QPIC_QPIC_BAM_P_EVNT_DEST_ADDR6_ADDR A:0x6799d82c
y.create.l HWIO_QPIC_QPIC_BAM_P_DF_CNTXT_0_ADDR A:0x67997830
y.create.l HWIO_QPIC_QPIC_BAM_P_DF_CNTXT_1_ADDR A:0x67998830
y.create.l HWIO_QPIC_QPIC_BAM_P_DF_CNTXT_2_ADDR A:0x67999830
y.create.l HWIO_QPIC_QPIC_BAM_P_DF_CNTXT_3_ADDR A:0x6799a830
y.create.l HWIO_QPIC_QPIC_BAM_P_DF_CNTXT_4_ADDR A:0x6799b830
y.create.l HWIO_QPIC_QPIC_BAM_P_DF_CNTXT_5_ADDR A:0x6799c830
y.create.l HWIO_QPIC_QPIC_BAM_P_DF_CNTXT_6_ADDR A:0x6799d830
y.create.l HWIO_QPIC_QPIC_BAM_P_RETR_CNTXT_0_ADDR A:0x67997834
y.create.l HWIO_QPIC_QPIC_BAM_P_RETR_CNTXT_1_ADDR A:0x67998834
y.create.l HWIO_QPIC_QPIC_BAM_P_RETR_CNTXT_2_ADDR A:0x67999834
y.create.l HWIO_QPIC_QPIC_BAM_P_RETR_CNTXT_3_ADDR A:0x6799a834
y.create.l HWIO_QPIC_QPIC_BAM_P_RETR_CNTXT_4_ADDR A:0x6799b834
y.create.l HWIO_QPIC_QPIC_BAM_P_RETR_CNTXT_5_ADDR A:0x6799c834
y.create.l HWIO_QPIC_QPIC_BAM_P_RETR_CNTXT_6_ADDR A:0x6799d834
y.create.l HWIO_QPIC_QPIC_BAM_P_SI_CNTXT_0_ADDR A:0x67997838
y.create.l HWIO_QPIC_QPIC_BAM_P_SI_CNTXT_1_ADDR A:0x67998838
y.create.l HWIO_QPIC_QPIC_BAM_P_SI_CNTXT_2_ADDR A:0x67999838
y.create.l HWIO_QPIC_QPIC_BAM_P_SI_CNTXT_3_ADDR A:0x6799a838
y.create.l HWIO_QPIC_QPIC_BAM_P_SI_CNTXT_4_ADDR A:0x6799b838
y.create.l HWIO_QPIC_QPIC_BAM_P_SI_CNTXT_5_ADDR A:0x6799c838
y.create.l HWIO_QPIC_QPIC_BAM_P_SI_CNTXT_6_ADDR A:0x6799d838
y.create.l HWIO_QPIC_QPIC_BAM_P_PSM_CNTXT_3_LSB0_ADDR A:0x67997900
y.create.l HWIO_QPIC_QPIC_BAM_P_PSM_CNTXT_3_LSB1_ADDR A:0x67998900
y.create.l HWIO_QPIC_QPIC_BAM_P_PSM_CNTXT_3_LSB2_ADDR A:0x67999900
y.create.l HWIO_QPIC_QPIC_BAM_P_PSM_CNTXT_3_LSB3_ADDR A:0x6799a900
y.create.l HWIO_QPIC_QPIC_BAM_P_PSM_CNTXT_3_LSB4_ADDR A:0x6799b900
y.create.l HWIO_QPIC_QPIC_BAM_P_PSM_CNTXT_3_LSB5_ADDR A:0x6799c900
y.create.l HWIO_QPIC_QPIC_BAM_P_PSM_CNTXT_3_LSB6_ADDR A:0x6799d900
y.create.l HWIO_QPIC_QPIC_BAM_P_PSM_CNTXT_3_MSB0_ADDR A:0x67997904
y.create.l HWIO_QPIC_QPIC_BAM_P_PSM_CNTXT_3_MSB1_ADDR A:0x67998904
y.create.l HWIO_QPIC_QPIC_BAM_P_PSM_CNTXT_3_MSB2_ADDR A:0x67999904
y.create.l HWIO_QPIC_QPIC_BAM_P_PSM_CNTXT_3_MSB3_ADDR A:0x6799a904
y.create.l HWIO_QPIC_QPIC_BAM_P_PSM_CNTXT_3_MSB4_ADDR A:0x6799b904
y.create.l HWIO_QPIC_QPIC_BAM_P_PSM_CNTXT_3_MSB5_ADDR A:0x6799c904
y.create.l HWIO_QPIC_QPIC_BAM_P_PSM_CNTXT_3_MSB6_ADDR A:0x6799d904
y.create.l HWIO_QPIC_QPIC_BAM_P_DESC_FIFO_ADDR_LSB0_ADDR A:0x67997910
y.create.l HWIO_QPIC_QPIC_BAM_P_DESC_FIFO_ADDR_LSB1_ADDR A:0x67998910
y.create.l HWIO_QPIC_QPIC_BAM_P_DESC_FIFO_ADDR_LSB2_ADDR A:0x67999910
y.create.l HWIO_QPIC_QPIC_BAM_P_DESC_FIFO_ADDR_LSB3_ADDR A:0x6799a910
y.create.l HWIO_QPIC_QPIC_BAM_P_DESC_FIFO_ADDR_LSB4_ADDR A:0x6799b910
y.create.l HWIO_QPIC_QPIC_BAM_P_DESC_FIFO_ADDR_LSB5_ADDR A:0x6799c910
y.create.l HWIO_QPIC_QPIC_BAM_P_DESC_FIFO_ADDR_LSB6_ADDR A:0x6799d910
y.create.l HWIO_QPIC_QPIC_BAM_P_DESC_FIFO_ADDR_MSB0_ADDR A:0x67997914
y.create.l HWIO_QPIC_QPIC_BAM_P_DESC_FIFO_ADDR_MSB1_ADDR A:0x67998914
y.create.l HWIO_QPIC_QPIC_BAM_P_DESC_FIFO_ADDR_MSB2_ADDR A:0x67999914
y.create.l HWIO_QPIC_QPIC_BAM_P_DESC_FIFO_ADDR_MSB3_ADDR A:0x6799a914
y.create.l HWIO_QPIC_QPIC_BAM_P_DESC_FIFO_ADDR_MSB4_ADDR A:0x6799b914
y.create.l HWIO_QPIC_QPIC_BAM_P_DESC_FIFO_ADDR_MSB5_ADDR A:0x6799c914
y.create.l HWIO_QPIC_QPIC_BAM_P_DESC_FIFO_ADDR_MSB6_ADDR A:0x6799d914
y.create.l HWIO_QPIC_QPIC_BAM_P_DATA_FIFO_ADDR_LSB0_ADDR A:0x67997920
y.create.l HWIO_QPIC_QPIC_BAM_P_DATA_FIFO_ADDR_LSB1_ADDR A:0x67998920
y.create.l HWIO_QPIC_QPIC_BAM_P_DATA_FIFO_ADDR_LSB2_ADDR A:0x67999920
y.create.l HWIO_QPIC_QPIC_BAM_P_DATA_FIFO_ADDR_LSB3_ADDR A:0x6799a920
y.create.l HWIO_QPIC_QPIC_BAM_P_DATA_FIFO_ADDR_LSB4_ADDR A:0x6799b920
y.create.l HWIO_QPIC_QPIC_BAM_P_DATA_FIFO_ADDR_LSB5_ADDR A:0x6799c920
y.create.l HWIO_QPIC_QPIC_BAM_P_DATA_FIFO_ADDR_LSB6_ADDR A:0x6799d920
y.create.l HWIO_QPIC_QPIC_BAM_P_DATA_FIFO_ADDR_MSB0_ADDR A:0x67997924
y.create.l HWIO_QPIC_QPIC_BAM_P_DATA_FIFO_ADDR_MSB1_ADDR A:0x67998924
y.create.l HWIO_QPIC_QPIC_BAM_P_DATA_FIFO_ADDR_MSB2_ADDR A:0x67999924
y.create.l HWIO_QPIC_QPIC_BAM_P_DATA_FIFO_ADDR_MSB3_ADDR A:0x6799a924
y.create.l HWIO_QPIC_QPIC_BAM_P_DATA_FIFO_ADDR_MSB4_ADDR A:0x6799b924
y.create.l HWIO_QPIC_QPIC_BAM_P_DATA_FIFO_ADDR_MSB5_ADDR A:0x6799c924
y.create.l HWIO_QPIC_QPIC_BAM_P_DATA_FIFO_ADDR_MSB6_ADDR A:0x6799d924
y.create.l HWIO_QPIC_QPIC_BAM_P_EVNT_DEST_ADDR_LSB0_ADDR A:0x67997930
y.create.l HWIO_QPIC_QPIC_BAM_P_EVNT_DEST_ADDR_LSB1_ADDR A:0x67998930
y.create.l HWIO_QPIC_QPIC_BAM_P_EVNT_DEST_ADDR_LSB2_ADDR A:0x67999930
y.create.l HWIO_QPIC_QPIC_BAM_P_EVNT_DEST_ADDR_LSB3_ADDR A:0x6799a930
y.create.l HWIO_QPIC_QPIC_BAM_P_EVNT_DEST_ADDR_LSB4_ADDR A:0x6799b930
y.create.l HWIO_QPIC_QPIC_BAM_P_EVNT_DEST_ADDR_LSB5_ADDR A:0x6799c930
y.create.l HWIO_QPIC_QPIC_BAM_P_EVNT_DEST_ADDR_LSB6_ADDR A:0x6799d930
y.create.l HWIO_QPIC_QPIC_BAM_P_EVNT_DEST_ADDR_MSB0_ADDR A:0x67997934
y.create.l HWIO_QPIC_QPIC_BAM_P_EVNT_DEST_ADDR_MSB1_ADDR A:0x67998934
y.create.l HWIO_QPIC_QPIC_BAM_P_EVNT_DEST_ADDR_MSB2_ADDR A:0x67999934
y.create.l HWIO_QPIC_QPIC_BAM_P_EVNT_DEST_ADDR_MSB3_ADDR A:0x6799a934
y.create.l HWIO_QPIC_QPIC_BAM_P_EVNT_DEST_ADDR_MSB4_ADDR A:0x6799b934
y.create.l HWIO_QPIC_QPIC_BAM_P_EVNT_DEST_ADDR_MSB5_ADDR A:0x6799c934
y.create.l HWIO_QPIC_QPIC_BAM_P_EVNT_DEST_ADDR_MSB6_ADDR A:0x6799d934
y.create.l HWIO_QPIC_QPIC_XPU_SCR_ADDR A:0x67982000
y.create.l HWIO_QPIC_QPIC_XPU_SWDR_ADDR A:0x67982004
y.create.l HWIO_QPIC_QPIC_XPU_SEAR0_ADDR A:0x67982040
y.create.l HWIO_QPIC_QPIC_XPU_SESR_ADDR A:0x67982048
y.create.l HWIO_QPIC_QPIC_XPU_SESRRESTORE_ADDR A:0x6798204c
y.create.l HWIO_QPIC_QPIC_XPU_SESYNR0_ADDR A:0x67982050
y.create.l HWIO_QPIC_QPIC_XPU_SESYNR1_ADDR A:0x67982054
y.create.l HWIO_QPIC_QPIC_XPU_SESYNR2_ADDR A:0x67982058
y.create.l HWIO_QPIC_QPIC_XPU_MCR_ADDR A:0x67982100
y.create.l HWIO_QPIC_QPIC_XPU_MEAR0_ADDR A:0x67982140
y.create.l HWIO_QPIC_QPIC_XPU_MESR_ADDR A:0x67982148
y.create.l HWIO_QPIC_QPIC_XPU_MESRRESTORE_ADDR A:0x6798214c
y.create.l HWIO_QPIC_QPIC_XPU_MESYNR0_ADDR A:0x67982150
y.create.l HWIO_QPIC_QPIC_XPU_MESYNR1_ADDR A:0x67982154
y.create.l HWIO_QPIC_QPIC_XPU_MESYNR2_ADDR A:0x67982158
y.create.l HWIO_QPIC_QPIC_XPU_CR_ADDR A:0x67982080
y.create.l HWIO_QPIC_QPIC_XPU_RPU_ACR0_ADDR A:0x679820a0
y.create.l HWIO_QPIC_QPIC_XPU_EAR0_ADDR A:0x679820c0
y.create.l HWIO_QPIC_QPIC_XPU_ESR_ADDR A:0x679820c8
y.create.l HWIO_QPIC_QPIC_XPU_ESRRESTORE_ADDR A:0x679820cc
y.create.l HWIO_QPIC_QPIC_XPU_ESYNR0_ADDR A:0x679820d0
y.create.l HWIO_QPIC_QPIC_XPU_ESYNR1_ADDR A:0x679820d4
y.create.l HWIO_QPIC_QPIC_XPU_ESYNR2_ADDR A:0x679820d8
y.create.l HWIO_QPIC_QPIC_XPU_IDR0_ADDR A:0x67982074
y.create.l HWIO_QPIC_QPIC_XPU_IDR1_ADDR A:0x67982078
y.create.l HWIO_QPIC_QPIC_XPU_REV_ADDR A:0x6798207c
y.create.l HWIO_QPIC_QPIC_XPU_RG0_RACR0_ADDR A:0x67982200
y.create.l HWIO_QPIC_QPIC_XPU_RG1_RACR0_ADDR A:0x67982280
y.create.l HWIO_QPIC_QPIC_XPU_RG2_RACR0_ADDR A:0x67982300
y.create.l HWIO_QPIC_QPIC_XPU_RG3_RACR0_ADDR A:0x67982380
y.create.l HWIO_QPIC_QPIC_XPU_RG4_RACR0_ADDR A:0x67982400
y.create.l HWIO_QPIC_QPIC_XPU_RG5_RACR0_ADDR A:0x67982480
y.create.l HWIO_QPIC_QPIC_XPU_RG6_RACR0_ADDR A:0x67982500
y.create.l HWIO_QPIC_QPIC_XPU_RG7_RACR0_ADDR A:0x67982580
y.create.l HWIO_QPIC_QPIC_XPU_RG8_RACR0_ADDR A:0x67982600
y.create.l HWIO_QPIC_QPIC_XPU_RG9_RACR0_ADDR A:0x67982680
y.create.l HWIO_QPIC_QPIC_XPU_RG0_SCR_ADDR A:0x67982250
y.create.l HWIO_QPIC_QPIC_XPU_RG1_SCR_ADDR A:0x679822d0
y.create.l HWIO_QPIC_QPIC_XPU_RG2_SCR_ADDR A:0x67982350
y.create.l HWIO_QPIC_QPIC_XPU_RG3_SCR_ADDR A:0x679823d0
y.create.l HWIO_QPIC_QPIC_XPU_RG4_SCR_ADDR A:0x67982450
y.create.l HWIO_QPIC_QPIC_XPU_RG5_SCR_ADDR A:0x679824d0
y.create.l HWIO_QPIC_QPIC_XPU_RG6_SCR_ADDR A:0x67982550
y.create.l HWIO_QPIC_QPIC_XPU_RG7_SCR_ADDR A:0x679825d0
y.create.l HWIO_QPIC_QPIC_XPU_RG8_SCR_ADDR A:0x67982650
y.create.l HWIO_QPIC_QPIC_XPU_RG9_SCR_ADDR A:0x679826d0
y.create.l HWIO_QPIC_QPIC_XPU_RG0_MCR_ADDR A:0x67982254
y.create.l HWIO_QPIC_QPIC_XPU_RG1_MCR_ADDR A:0x679822d4
y.create.l HWIO_QPIC_QPIC_XPU_RG2_MCR_ADDR A:0x67982354
y.create.l HWIO_QPIC_QPIC_XPU_RG3_MCR_ADDR A:0x679823d4
y.create.l HWIO_QPIC_QPIC_XPU_RG4_MCR_ADDR A:0x67982454
y.create.l HWIO_QPIC_QPIC_XPU_RG5_MCR_ADDR A:0x679824d4
y.create.l HWIO_QPIC_QPIC_XPU_RG6_MCR_ADDR A:0x67982554
y.create.l HWIO_QPIC_QPIC_XPU_RG7_MCR_ADDR A:0x679825d4
y.create.l HWIO_QPIC_QPIC_XPU_RG8_MCR_ADDR A:0x67982654
y.create.l HWIO_QPIC_QPIC_XPU_RG9_MCR_ADDR A:0x679826d4
y.create.l HWIO_QPIC_QPIC_VMIDMT_SCR0_ADDR A:0x67980000
y.create.l HWIO_QPIC_QPIC_VMIDMT_SCR1_ADDR A:0x67980004
y.create.l HWIO_QPIC_QPIC_VMIDMT_SCR2_ADDR A:0x67980008
y.create.l HWIO_QPIC_QPIC_VMIDMT_SACR_ADDR A:0x67980010
y.create.l HWIO_QPIC_QPIC_VMIDMT_SIDR0_ADDR A:0x67980020
y.create.l HWIO_QPIC_QPIC_VMIDMT_SIDR1_ADDR A:0x67980024
y.create.l HWIO_QPIC_QPIC_VMIDMT_SIDR2_ADDR A:0x67980028
y.create.l HWIO_QPIC_QPIC_VMIDMT_SIDR4_ADDR A:0x67980030
y.create.l HWIO_QPIC_QPIC_VMIDMT_SIDR5_ADDR A:0x67980034
y.create.l HWIO_QPIC_QPIC_VMIDMT_SIDR7_ADDR A:0x6798003c
y.create.l HWIO_QPIC_QPIC_VMIDMT_SGFAR0_ADDR A:0x67980040
y.create.l HWIO_QPIC_QPIC_VMIDMT_SGFSR_ADDR A:0x67980048
y.create.l HWIO_QPIC_QPIC_VMIDMT_SGFSRRESTORE_ADDR A:0x6798004c
y.create.l HWIO_QPIC_QPIC_VMIDMT_SGFSYNDR0_ADDR A:0x67980050
y.create.l HWIO_QPIC_QPIC_VMIDMT_SGFSYNDR1_ADDR A:0x67980054
y.create.l HWIO_QPIC_QPIC_VMIDMT_SGFSYNDR2_ADDR A:0x67980058
y.create.l HWIO_QPIC_QPIC_VMIDMT_VMIDMTSCR0_ADDR A:0x67980090
y.create.l HWIO_QPIC_QPIC_VMIDMT_CR0_ADDR A:0x67980000
y.create.l HWIO_QPIC_QPIC_VMIDMT_CR2_ADDR A:0x67980008
y.create.l HWIO_QPIC_QPIC_VMIDMT_ACR_ADDR A:0x67980010
y.create.l HWIO_QPIC_QPIC_VMIDMT_IDR0_ADDR A:0x67980020
y.create.l HWIO_QPIC_QPIC_VMIDMT_IDR1_ADDR A:0x67980024
y.create.l HWIO_QPIC_QPIC_VMIDMT_IDR2_ADDR A:0x67980028
y.create.l HWIO_QPIC_QPIC_VMIDMT_IDR4_ADDR A:0x67980030
y.create.l HWIO_QPIC_QPIC_VMIDMT_IDR5_ADDR A:0x67980034
y.create.l HWIO_QPIC_QPIC_VMIDMT_IDR7_ADDR A:0x6798003c
y.create.l HWIO_QPIC_QPIC_VMIDMT_GFAR0_ADDR A:0x67980040
y.create.l HWIO_QPIC_QPIC_VMIDMT_GFSR_ADDR A:0x67980048
y.create.l HWIO_QPIC_QPIC_VMIDMT_GFSRRESTORE_ADDR A:0x6798004c
y.create.l HWIO_QPIC_QPIC_VMIDMT_GFSYNDR0_ADDR A:0x67980050
y.create.l HWIO_QPIC_QPIC_VMIDMT_GFSYNDR1_ADDR A:0x67980054
y.create.l HWIO_QPIC_QPIC_VMIDMT_GFSYNDR2_ADDR A:0x67980058
y.create.l HWIO_QPIC_QPIC_VMIDMT_VMIDMTCR0_ADDR A:0x67980090
y.create.l HWIO_QPIC_QPIC_VMIDMT_VMIDMTACR_ADDR A:0x6798009c
y.create.l HWIO_QPIC_QPIC_VMIDMT_NSCR0_ADDR A:0x67980400
y.create.l HWIO_QPIC_QPIC_VMIDMT_NSCR2_ADDR A:0x67980408
y.create.l HWIO_QPIC_QPIC_VMIDMT_NSACR_ADDR A:0x67980410
y.create.l HWIO_QPIC_QPIC_VMIDMT_NSGFAR0_ADDR A:0x67980440
y.create.l HWIO_QPIC_QPIC_VMIDMT_NSGFSR_ADDR A:0x67980448
y.create.l HWIO_QPIC_QPIC_VMIDMT_NSGFSRRESTORE_ADDR A:0x6798044c
y.create.l HWIO_QPIC_QPIC_VMIDMT_NSGFSYNDR0_ADDR A:0x67980450
y.create.l HWIO_QPIC_QPIC_VMIDMT_NSGFSYNDR1_ADDR A:0x67980454
y.create.l HWIO_QPIC_QPIC_VMIDMT_NSGFSYNDR2_ADDR A:0x67980458
y.create.l HWIO_QPIC_QPIC_VMIDMT_NSVMIDMTCR0_ADDR A:0x67980490
y.create.l HWIO_QPIC_QPIC_VMIDMT_SSDR0_ADDR A:0x67980080
y.create.l HWIO_QPIC_QPIC_VMIDMT_MSDR0_ADDR A:0x67980480
y.create.l HWIO_QPIC_QPIC_VMIDMT_MCR_ADDR A:0x67980494
y.create.l HWIO_QPIC_QPIC_VMIDMT_S2VR0_ADDR A:0x67980c00
y.create.l HWIO_QPIC_QPIC_VMIDMT_S2VR1_ADDR A:0x67980c04
y.create.l HWIO_QPIC_QPIC_VMIDMT_S2VR2_ADDR A:0x67980c08
y.create.l HWIO_QPIC_QPIC_VMIDMT_S2VR3_ADDR A:0x67980c0c
y.create.l HWIO_QPIC_QPIC_VMIDMT_S2VR4_ADDR A:0x67980c10
y.create.l HWIO_QPIC_QPIC_VMIDMT_S2VR5_ADDR A:0x67980c14
y.create.l HWIO_QPIC_QPIC_VMIDMT_S2VR6_ADDR A:0x67980c18
y.create.l HWIO_QPIC_QPIC_VMIDMT_S2VR7_ADDR A:0x67980c1c
y.create.l HWIO_QPIC_QPIC_VMIDMT_AS2VR0_ADDR A:0x67980e00
y.create.l HWIO_QPIC_QPIC_VMIDMT_AS2VR1_ADDR A:0x67980e04
y.create.l HWIO_QPIC_QPIC_VMIDMT_AS2VR2_ADDR A:0x67980e08
y.create.l HWIO_QPIC_QPIC_VMIDMT_AS2VR3_ADDR A:0x67980e0c
y.create.l HWIO_QPIC_QPIC_VMIDMT_AS2VR4_ADDR A:0x67980e10
y.create.l HWIO_QPIC_QPIC_VMIDMT_AS2VR5_ADDR A:0x67980e14
y.create.l HWIO_QPIC_QPIC_VMIDMT_AS2VR6_ADDR A:0x67980e18
y.create.l HWIO_QPIC_QPIC_VMIDMT_AS2VR7_ADDR A:0x67980e1c
y.create.l HWIO_QPIC_QPIC_VMIDMT_SMR0_ADDR A:0x67980800
y.create.l HWIO_QPIC_QPIC_VMIDMT_SMR1_ADDR A:0x67980804
y.create.l HWIO_QPIC_QPIC_VMIDMT_SMR2_ADDR A:0x67980808
y.create.l HWIO_QPIC_QPIC_VMIDMT_SMR3_ADDR A:0x6798080c
y.create.l HWIO_QPIC_QPIC_VMIDMT_SMR4_ADDR A:0x67980810
y.create.l HWIO_QPIC_QPIC_VMIDMT_SMR5_ADDR A:0x67980814
y.create.l HWIO_QPIC_QPIC_VMIDMT_SMR6_ADDR A:0x67980818
y.create.l HWIO_QPIC_QPIC_VMIDMT_SMR7_ADDR A:0x6798081c
y.create.l HWIO_QPIC_EBI2_CHIP_SELECT_CFG0_ADDR A:0x679a0000
y.create.l HWIO_QPIC_EBI2_CFG_ADDR A:0x679a0004
y.create.l HWIO_QPIC_EBI2_ARBITER_CFG_ADDR A:0x679a0030
y.create.l HWIO_QPIC_EBI2_DEBUG_REG_LSB_ADDR A:0x679a0048
y.create.l HWIO_QPIC_EBI2_DEBUG_REG_MSB_ADDR A:0x679a004c
y.create.l HWIO_QPIC_EBI2_DEBUG_SEL_ADDR A:0x679a0050
y.create.l HWIO_QPIC_EBI2_CRC_CFG_ADDR A:0x679a0054
y.create.l HWIO_QPIC_EBI2_CRC_REMINDER_CFG_ADDR A:0x679a0058
y.create.l HWIO_QPIC_EBI2_NAND_ADM_MUX_ADDR A:0x679a005c
y.create.l HWIO_QPIC_EBI2_CLKON_CFG_ADDR A:0x679a0068
y.create.l HWIO_QPIC_EBI2_CORE_CLKON_CFG_ADDR A:0x679a006c
y.create.l HWIO_QPIC_QPIC_LCDC_CTRL_ADDR A:0x679a2000
y.create.l HWIO_QPIC_LCDC_VERSION_ADDR A:0x679a2004
y.create.l HWIO_QPIC_QPIC_LCDC_IRQ_EN_ADDR A:0x679a2008
y.create.l HWIO_QPIC_QPIC_LCDC_IRQ_STTS_ADDR A:0x679a200c
y.create.l HWIO_QPIC_QPIC_LCDC_IRQ_CLR_ADDR A:0x679a2010
y.create.l HWIO_QPIC_QPIC_LCDC_STTS_ADDR A:0x679a2014
y.create.l HWIO_QPIC_QPIC_LCDC_CMD_DATA_CYCLE_CNT_ADDR A:0x679a2018
y.create.l HWIO_QPIC_QPIC_LCDC_CFG0_ADDR A:0x679a2020
y.create.l HWIO_QPIC_QPIC_LCDC_CFG1_ADDR A:0x679a2024
y.create.l HWIO_QPIC_QPIC_LCDC_CFG2_ADDR A:0x679a2028
y.create.l HWIO_QPIC_QPIC_LCDC_RESET_ADDR A:0x679a202c
y.create.l HWIO_QPIC_QPIC_LCD_DEVICE_RESET_ADDR A:0x679a2030
y.create.l HWIO_QPIC_QPIC_LCDC_FIFO_SOF_ADDR A:0x679a2100
y.create.l HWIO_QPIC_QPIC_LCDC_FIFO_DATA_PORT0_ADDR A:0x679a2140
y.create.l HWIO_QPIC_QPIC_LCDC_FIFO_DATA_PORT1_ADDR A:0x679a2144
y.create.l HWIO_QPIC_QPIC_LCDC_FIFO_DATA_PORT2_ADDR A:0x679a2148
y.create.l HWIO_QPIC_QPIC_LCDC_FIFO_DATA_PORT3_ADDR A:0x679a214c
y.create.l HWIO_QPIC_QPIC_LCDC_FIFO_DATA_PORT4_ADDR A:0x679a2150
y.create.l HWIO_QPIC_QPIC_LCDC_FIFO_DATA_PORT5_ADDR A:0x679a2154
y.create.l HWIO_QPIC_QPIC_LCDC_FIFO_DATA_PORT6_ADDR A:0x679a2158
y.create.l HWIO_QPIC_QPIC_LCDC_FIFO_DATA_PORT7_ADDR A:0x679a215c
y.create.l HWIO_QPIC_QPIC_LCDC_FIFO_DATA_PORT8_ADDR A:0x679a2160
y.create.l HWIO_QPIC_QPIC_LCDC_FIFO_DATA_PORT9_ADDR A:0x679a2164
y.create.l HWIO_QPIC_QPIC_LCDC_FIFO_EOF_ADDR A:0x679a2180
y.create.l HWIO_QPIC_LCD_DEVICE_CMD0_ADDR A:0x679a3000
y.create.l HWIO_QPIC_LCD_DEVICE_CMD1_ADDR A:0x679a3004
y.create.l HWIO_QPIC_LCD_DEVICE_CMD2_ADDR A:0x679a3008
y.create.l HWIO_QPIC_LCD_DEVICE_CMD3_ADDR A:0x679a300c
y.create.l HWIO_QPIC_LCD_DEVICE_CMD4_ADDR A:0x679a3010
y.create.l HWIO_QPIC_LCD_DEVICE_CMD5_ADDR A:0x679a3014
y.create.l HWIO_QPIC_LCD_DEVICE_CMD6_ADDR A:0x679a3018
y.create.l HWIO_QPIC_LCD_DEVICE_CMD7_ADDR A:0x679a301c
y.create.l HWIO_QPIC_LCD_DEVICE_CMD8_ADDR A:0x679a3020
y.create.l HWIO_QPIC_LCD_DEVICE_CMD9_ADDR A:0x679a3024
y.create.l HWIO_QPIC_QPIC_VERSION_ADDR A:0x679a0100
y.create.l HWIO_QPIC_QPIC_CTRL_ADDR A:0x679a0104
y.create.l HWIO_QPIC_QPIC_HW_INFO_ADDR A:0x679a0108
y.create.l HWIO_QPIC_QPIC_REG_PERMISSION_ADDR A:0x679a010c
y.create.l HWIO_QPIC_QPIC_DEBUG_ADDR A:0x679a0110
y.create.l HWIO_QPIC_QPIC_HW_GENERICS_ADDR A:0x679a0114
y.create.l HWIO_QPIC_NAND_FLASH_CMD_ADDR A:0x679b0000
y.create.l HWIO_QPIC_NAND_ADDR0_ADDR A:0x679b0004
y.create.l HWIO_QPIC_NAND_ADDR1_ADDR A:0x679b0008
y.create.l HWIO_QPIC_NAND_FLASH_CHIP_SELECT_ADDR A:0x679b000c
y.create.l HWIO_QPIC_NANDC_EXEC_CMD_ADDR A:0x679b0010
y.create.l HWIO_QPIC_NAND_FLASH_STATUS_ADDR A:0x679b0014
y.create.l HWIO_QPIC_NANDC_BUFFER_STATUS_ADDR A:0x679b0018
y.create.l HWIO_QPIC_NAND_DEV0_CFG0_ADDR A:0x679b0020
y.create.l HWIO_QPIC_NAND_DEV1_CFG0_ADDR A:0x679b0030
y.create.l HWIO_QPIC_NAND_DEV0_CFG1_ADDR A:0x679b0024
y.create.l HWIO_QPIC_NAND_DEV1_CFG1_ADDR A:0x679b0034
y.create.l HWIO_QPIC_NAND_DEV0_ECC_CFG_ADDR A:0x679b0028
y.create.l HWIO_QPIC_NAND_DEV1_ECC_CFG_ADDR A:0x679b002c
y.create.l HWIO_QPIC_NAND_FLASH_READ_ID_ADDR A:0x679b0040
y.create.l HWIO_QPIC_NAND_FLASH_READ_ID2_ADDR A:0x679b0048
y.create.l HWIO_QPIC_NAND_FLASH_READ_STATUS_ADDR A:0x679b0044
y.create.l HWIO_QPIC_NAND_FLASH_CONFIG_DATA_ADDR A:0x679b0050
y.create.l HWIO_QPIC_NAND_FLASH_CONFIG_ADDR A:0x679b0054
y.create.l HWIO_QPIC_NAND_FLASH_CONFIG_MODE_ADDR A:0x679b0058
y.create.l HWIO_QPIC_NAND_FLASH_CONFIG_STATUS_ADDR A:0x679b0060
y.create.l HWIO_QPIC_FLASH_MACRO1_REG_ADDR A:0x679b0064
y.create.l HWIO_QPIC_HSDDR_NAND_CFG_ADDR A:0x679b0068
y.create.l HWIO_QPIC_FLASH_XFR_STEP1_ADDR A:0x679b0070
y.create.l HWIO_QPIC_FLASH_XFR_STEP2_ADDR A:0x679b0074
y.create.l HWIO_QPIC_FLASH_XFR_STEP3_ADDR A:0x679b0078
y.create.l HWIO_QPIC_FLASH_XFR_STEP4_ADDR A:0x679b007c
y.create.l HWIO_QPIC_FLASH_XFR_STEP5_ADDR A:0x679b0080
y.create.l HWIO_QPIC_FLASH_XFR_STEP6_ADDR A:0x679b0084
y.create.l HWIO_QPIC_FLASH_XFR_STEP7_ADDR A:0x679b0088
y.create.l HWIO_QPIC_NAND_GENP_REG0_ADDR A:0x679b0090
y.create.l HWIO_QPIC_NAND_GENP_REG1_ADDR A:0x679b0094
y.create.l HWIO_QPIC_NAND_GENP_REG2_ADDR A:0x679b0098
y.create.l HWIO_QPIC_NAND_GENP_REG3_ADDR A:0x679b009c
y.create.l HWIO_QPIC_FLASH_DEV_CMD0_ADDR A:0x679b00a0
y.create.l HWIO_QPIC_FLASH_DEV_CMD1_ADDR A:0x679b00a4
y.create.l HWIO_QPIC_FLASH_DEV_CMD2_ADDR A:0x679b00a8
y.create.l HWIO_QPIC_FLASH_DEV_CMD_VLD_ADDR A:0x679b00ac
y.create.l HWIO_QPIC_NAND_ADDR2_ADDR A:0x679b00c0
y.create.l HWIO_QPIC_NAND_ADDR3_ADDR A:0x679b00c4
y.create.l HWIO_QPIC_NAND_ADDR4_ADDR A:0x679b00c8
y.create.l HWIO_QPIC_NAND_ADDR5_ADDR A:0x679b00cc
y.create.l HWIO_QPIC_FLASH_DEV_CMD3_ADDR A:0x679b00d0
y.create.l HWIO_QPIC_FLASH_DEV_CMD4_ADDR A:0x679b00d4
y.create.l HWIO_QPIC_FLASH_DEV_CMD5_ADDR A:0x679b00d8
y.create.l HWIO_QPIC_FLASH_DEV_CMD6_ADDR A:0x679b00dc
y.create.l HWIO_QPIC_NAND_ADDR6_ADDR A:0x679b00e4
y.create.l HWIO_QPIC_NAND_ERASED_CW_DETECT_CFG_ADDR A:0x679b00e8
y.create.l HWIO_QPIC_NAND_ERASED_CW_DETECT_STATUS_ADDR A:0x679b00ec
y.create.l HWIO_QPIC_EBI2_ECC_BUF_CFG_ADDR A:0x679b00f0
y.create.l HWIO_QPIC_NANDC_DBG_CFG_ADDR A:0x679b00f4
y.create.l HWIO_QPIC_NANDC_HW_PROFILE_CFG_ADDR A:0x679b00f8
y.create.l HWIO_QPIC_FLASH_BUFF0_ACC_ADDR A:0x679b0100
y.create.l HWIO_QPIC_FLASH_BUFF1_ACC_ADDR A:0x679b0104
y.create.l HWIO_QPIC_FLASH_BUFF2_ACC_ADDR A:0x679b0108
y.create.l HWIO_QPIC_FLASH_BUFF3_ACC_ADDR A:0x679b010c
y.create.l HWIO_QPIC_FLASH_BUFF4_ACC_ADDR A:0x679b0110
y.create.l HWIO_QPIC_FLASH_BUFF5_ACC_ADDR A:0x679b0114
y.create.l HWIO_QPIC_FLASH_BUFF6_ACC_ADDR A:0x679b0118
y.create.l HWIO_QPIC_FLASH_BUFF7_ACC_ADDR A:0x679b011c
y.create.l HWIO_QPIC_FLASH_BUFF8_ACC_ADDR A:0x679b0120
y.create.l HWIO_QPIC_FLASH_BUFF9_ACC_ADDR A:0x679b0124
y.create.l HWIO_QPIC_NAND_CTRL_ADDR A:0x679b0f00
y.create.l HWIO_QPIC_NAND_STATUS_ADDR A:0x679b0f04
y.create.l HWIO_QPIC_NAND_VERSION_ADDR A:0x679b0f08
y.create.l HWIO_QPIC_NAND_MPU_BYPASS_ADDR A:0x679b0f44
y.create.l HWIO_QPIC_NAND_DEBUG_ADDR A:0x679b0f0c
y.create.l HWIO_QPIC_NAND_IRQ_STTS_ADDR A:0x679b0f10
y.create.l HWIO_QPIC_NAND_IRQ_CLR_ADDR A:0x679b0f14
y.create.l HWIO_QPIC_NAND_IRQ_EN_ADDR A:0x679b0f18
y.create.l HWIO_QPIC_NAND_MUTEX_ADDR A:0x679b0f1c
y.create.l HWIO_QPIC_NAND_CONFIG_BITS_ADDR A:0x679b0f40
y.create.l HWIO_QPIC_NAND_READ_LOCATION_0_ADDR A:0x679b0f20
y.create.l HWIO_QPIC_NAND_READ_LOCATION_1_ADDR A:0x679b0f24
y.create.l HWIO_QPIC_NAND_READ_LOCATION_2_ADDR A:0x679b0f28
y.create.l HWIO_QPIC_NAND_READ_LOCATION_3_ADDR A:0x679b0f2c
y.create.l HWIO_QPIC_NAND_READ_LOCATION_4_ADDR A:0x679b0f30
y.create.l HWIO_QPIC_NAND_TEST_BUS_LSB_ADDR A:0x679b0f48
y.create.l HWIO_QPIC_NAND_TEST_BUS_MSB_ADDR A:0x679b0f4c
y.create.l HWIO_QPIC_NAND_OP_DONE_CNT_ADDR A:0x679b0f50
y.create.l HWIO_QPIC_NAND_ERR_RESP_TIME_OUT_ADDR A:0x679b0f54
y.create.l HWIO_QPIC_QPIC_MPU_XPU_SCR_ADDR A:0x679b1000
y.create.l HWIO_QPIC_QPIC_MPU_XPU_SWDR_ADDR A:0x679b1004
y.create.l HWIO_QPIC_QPIC_MPU_XPU_PRTN_RACR_SSHADOW_ADDR A:0x679b1008
y.create.l HWIO_QPIC_QPIC_MPU_XPU_PRTN_WACR_SSHADOW_ADDR A:0x679b100c
y.create.l HWIO_QPIC_QPIC_MPU_XPU_PRTN_START_SSHADOW0_ADDR A:0x679b1010
y.create.l HWIO_QPIC_QPIC_MPU_XPU_PRTN_START_SSHADOW1_ADDR A:0x679b1014
y.create.l HWIO_QPIC_QPIC_MPU_XPU_PRTN_END_SSHADOW0_ADDR A:0x679b1018
y.create.l HWIO_QPIC_QPIC_MPU_XPU_PRTN_END_SSHADOW1_ADDR A:0x679b101c
y.create.l HWIO_QPIC_QPIC_MPU_XPU_SEAR0_ADDR A:0x679b1040
y.create.l HWIO_QPIC_QPIC_MPU_XPU_SEAR1_ADDR A:0x679b1044
y.create.l HWIO_QPIC_QPIC_MPU_XPU_SESR_ADDR A:0x679b1048
y.create.l HWIO_QPIC_QPIC_MPU_XPU_SESRRESTORE_ADDR A:0x679b104c
y.create.l HWIO_QPIC_QPIC_MPU_XPU_SESYNR0_ADDR A:0x679b1050
y.create.l HWIO_QPIC_QPIC_MPU_XPU_SESYNR1_ADDR A:0x679b1054
y.create.l HWIO_QPIC_QPIC_MPU_XPU_SESYNR2_ADDR A:0x679b1058
y.create.l HWIO_QPIC_QPIC_MPU_XPU_MCR_ADDR A:0x679b1100
y.create.l HWIO_QPIC_QPIC_MPU_XPU_MEAR0_ADDR A:0x679b1140
y.create.l HWIO_QPIC_QPIC_MPU_XPU_MEAR1_ADDR A:0x679b1144
y.create.l HWIO_QPIC_QPIC_MPU_XPU_MESR_ADDR A:0x679b1148
y.create.l HWIO_QPIC_QPIC_MPU_XPU_MESRRESTORE_ADDR A:0x679b114c
y.create.l HWIO_QPIC_QPIC_MPU_XPU_MESYNR0_ADDR A:0x679b1150
y.create.l HWIO_QPIC_QPIC_MPU_XPU_MESYNR1_ADDR A:0x679b1154
y.create.l HWIO_QPIC_QPIC_MPU_XPU_MESYNR2_ADDR A:0x679b1158
y.create.l HWIO_QPIC_QPIC_MPU_XPU_CR_ADDR A:0x679b1080
y.create.l HWIO_QPIC_QPIC_MPU_XPU_PRTN_RACR_SHADOW_ADDR A:0x679b1088
y.create.l HWIO_QPIC_QPIC_MPU_XPU_PRTN_WACR_SHADOW_ADDR A:0x679b108c
y.create.l HWIO_QPIC_QPIC_MPU_XPU_PRTN_START_SHADOW0_ADDR A:0x679b1090
y.create.l HWIO_QPIC_QPIC_MPU_XPU_PRTN_START_SHADOW1_ADDR A:0x679b1094
y.create.l HWIO_QPIC_QPIC_MPU_XPU_PRTN_END_SHADOW0_ADDR A:0x679b1098
y.create.l HWIO_QPIC_QPIC_MPU_XPU_PRTN_END_SHADOW1_ADDR A:0x679b109c
y.create.l HWIO_QPIC_QPIC_MPU_XPU_RPU_ACR0_ADDR A:0x679b10a0
y.create.l HWIO_QPIC_QPIC_MPU_XPU_EAR0_ADDR A:0x679b10c0
y.create.l HWIO_QPIC_QPIC_MPU_XPU_EAR1_ADDR A:0x679b10c4
y.create.l HWIO_QPIC_QPIC_MPU_XPU_ESR_ADDR A:0x679b10c8
y.create.l HWIO_QPIC_QPIC_MPU_XPU_ESRRESTORE_ADDR A:0x679b10cc
y.create.l HWIO_QPIC_QPIC_MPU_XPU_ESYNR0_ADDR A:0x679b10d0
y.create.l HWIO_QPIC_QPIC_MPU_XPU_ESYNR1_ADDR A:0x679b10d4
y.create.l HWIO_QPIC_QPIC_MPU_XPU_ESYNR2_ADDR A:0x679b10d8
y.create.l HWIO_QPIC_QPIC_MPU_XPU_UMR_RACR_ADDR A:0x679b10e0
y.create.l HWIO_QPIC_QPIC_MPU_XPU_UMR_WACR_ADDR A:0x679b10e4
y.create.l HWIO_QPIC_QPIC_MPU_XPU_UMR_CNTL_ADDR A:0x679b10f0
y.create.l HWIO_QPIC_QPIC_MPU_XPU_IDR0_ADDR A:0x679b1074
y.create.l HWIO_QPIC_QPIC_MPU_XPU_IDR1_ADDR A:0x679b1078
y.create.l HWIO_QPIC_QPIC_MPU_XPU_REV_ADDR A:0x679b107c
y.create.l HWIO_QPIC_QPIC_MPU_XPU_PRT0_RACR0_ADDR A:0x679b1200
y.create.l HWIO_QPIC_QPIC_MPU_XPU_PRT1_RACR0_ADDR A:0x679b1280
y.create.l HWIO_QPIC_QPIC_MPU_XPU_PRT2_RACR0_ADDR A:0x679b1300
y.create.l HWIO_QPIC_QPIC_MPU_XPU_PRT3_RACR0_ADDR A:0x679b1380
y.create.l HWIO_QPIC_QPIC_MPU_XPU_PRT4_RACR0_ADDR A:0x679b1400
y.create.l HWIO_QPIC_QPIC_MPU_XPU_PRT5_RACR0_ADDR A:0x679b1480
y.create.l HWIO_QPIC_QPIC_MPU_XPU_PRT6_RACR0_ADDR A:0x679b1500
y.create.l HWIO_QPIC_QPIC_MPU_XPU_PRT7_RACR0_ADDR A:0x679b1580
y.create.l HWIO_QPIC_QPIC_MPU_XPU_PRT0_WACR0_ADDR A:0x679b1220
y.create.l HWIO_QPIC_QPIC_MPU_XPU_PRT1_WACR0_ADDR A:0x679b12a0
y.create.l HWIO_QPIC_QPIC_MPU_XPU_PRT2_WACR0_ADDR A:0x679b1320
y.create.l HWIO_QPIC_QPIC_MPU_XPU_PRT3_WACR0_ADDR A:0x679b13a0
y.create.l HWIO_QPIC_QPIC_MPU_XPU_PRT4_WACR0_ADDR A:0x679b1420
y.create.l HWIO_QPIC_QPIC_MPU_XPU_PRT5_WACR0_ADDR A:0x679b14a0
y.create.l HWIO_QPIC_QPIC_MPU_XPU_PRT6_WACR0_ADDR A:0x679b1520
y.create.l HWIO_QPIC_QPIC_MPU_XPU_PRT7_WACR0_ADDR A:0x679b15a0
y.create.l HWIO_QPIC_QPIC_MPU_XPU_PRT0_START0_ADDR A:0x679b1240
y.create.l HWIO_QPIC_QPIC_MPU_XPU_PRT1_START0_ADDR A:0x679b12c0
y.create.l HWIO_QPIC_QPIC_MPU_XPU_PRT2_START0_ADDR A:0x679b1340
y.create.l HWIO_QPIC_QPIC_MPU_XPU_PRT3_START0_ADDR A:0x679b13c0
y.create.l HWIO_QPIC_QPIC_MPU_XPU_PRT4_START0_ADDR A:0x679b1440
y.create.l HWIO_QPIC_QPIC_MPU_XPU_PRT5_START0_ADDR A:0x679b14c0
y.create.l HWIO_QPIC_QPIC_MPU_XPU_PRT6_START0_ADDR A:0x679b1540
y.create.l HWIO_QPIC_QPIC_MPU_XPU_PRT7_START0_ADDR A:0x679b15c0
y.create.l HWIO_QPIC_QPIC_MPU_XPU_PRT0_START1_ADDR A:0x679b1244
y.create.l HWIO_QPIC_QPIC_MPU_XPU_PRT1_START1_ADDR A:0x679b12c4
y.create.l HWIO_QPIC_QPIC_MPU_XPU_PRT2_START1_ADDR A:0x679b1344
y.create.l HWIO_QPIC_QPIC_MPU_XPU_PRT3_START1_ADDR A:0x679b13c4
y.create.l HWIO_QPIC_QPIC_MPU_XPU_PRT4_START1_ADDR A:0x679b1444
y.create.l HWIO_QPIC_QPIC_MPU_XPU_PRT5_START1_ADDR A:0x679b14c4
y.create.l HWIO_QPIC_QPIC_MPU_XPU_PRT6_START1_ADDR A:0x679b1544
y.create.l HWIO_QPIC_QPIC_MPU_XPU_PRT7_START1_ADDR A:0x679b15c4
y.create.l HWIO_QPIC_QPIC_MPU_XPU_PRT0_END0_ADDR A:0x679b1248
y.create.l HWIO_QPIC_QPIC_MPU_XPU_PRT1_END0_ADDR A:0x679b12c8
y.create.l HWIO_QPIC_QPIC_MPU_XPU_PRT2_END0_ADDR A:0x679b1348
y.create.l HWIO_QPIC_QPIC_MPU_XPU_PRT3_END0_ADDR A:0x679b13c8
y.create.l HWIO_QPIC_QPIC_MPU_XPU_PRT4_END0_ADDR A:0x679b1448
y.create.l HWIO_QPIC_QPIC_MPU_XPU_PRT5_END0_ADDR A:0x679b14c8
y.create.l HWIO_QPIC_QPIC_MPU_XPU_PRT6_END0_ADDR A:0x679b1548
y.create.l HWIO_QPIC_QPIC_MPU_XPU_PRT7_END0_ADDR A:0x679b15c8
y.create.l HWIO_QPIC_QPIC_MPU_XPU_PRT0_END1_ADDR A:0x679b124c
y.create.l HWIO_QPIC_QPIC_MPU_XPU_PRT1_END1_ADDR A:0x679b12cc
y.create.l HWIO_QPIC_QPIC_MPU_XPU_PRT2_END1_ADDR A:0x679b134c
y.create.l HWIO_QPIC_QPIC_MPU_XPU_PRT3_END1_ADDR A:0x679b13cc
y.create.l HWIO_QPIC_QPIC_MPU_XPU_PRT4_END1_ADDR A:0x679b144c
y.create.l HWIO_QPIC_QPIC_MPU_XPU_PRT5_END1_ADDR A:0x679b14cc
y.create.l HWIO_QPIC_QPIC_MPU_XPU_PRT6_END1_ADDR A:0x679b154c
y.create.l HWIO_QPIC_QPIC_MPU_XPU_PRT7_END1_ADDR A:0x679b15cc
y.create.l HWIO_QPIC_QPIC_MPU_XPU_PRT0_SCR_ADDR A:0x679b1250
y.create.l HWIO_QPIC_QPIC_MPU_XPU_PRT1_SCR_ADDR A:0x679b12d0
y.create.l HWIO_QPIC_QPIC_MPU_XPU_PRT2_SCR_ADDR A:0x679b1350
y.create.l HWIO_QPIC_QPIC_MPU_XPU_PRT3_SCR_ADDR A:0x679b13d0
y.create.l HWIO_QPIC_QPIC_MPU_XPU_PRT4_SCR_ADDR A:0x679b1450
y.create.l HWIO_QPIC_QPIC_MPU_XPU_PRT5_SCR_ADDR A:0x679b14d0
y.create.l HWIO_QPIC_QPIC_MPU_XPU_PRT6_SCR_ADDR A:0x679b1550
y.create.l HWIO_QPIC_QPIC_MPU_XPU_PRT7_SCR_ADDR A:0x679b15d0
y.create.l HWIO_QPIC_QPIC_MPU_XPU_PRT0_MCR_ADDR A:0x679b1254
y.create.l HWIO_QPIC_QPIC_MPU_XPU_PRT1_MCR_ADDR A:0x679b12d4
y.create.l HWIO_QPIC_QPIC_MPU_XPU_PRT2_MCR_ADDR A:0x679b1354
y.create.l HWIO_QPIC_QPIC_MPU_XPU_PRT3_MCR_ADDR A:0x679b13d4
y.create.l HWIO_QPIC_QPIC_MPU_XPU_PRT4_MCR_ADDR A:0x679b1454
y.create.l HWIO_QPIC_QPIC_MPU_XPU_PRT5_MCR_ADDR A:0x679b14d4
y.create.l HWIO_QPIC_QPIC_MPU_XPU_PRT6_MCR_ADDR A:0x679b1554
y.create.l HWIO_QPIC_QPIC_MPU_XPU_PRT7_MCR_ADDR A:0x679b15d4
y.create.l HWIO_QPIC_QPIC_MPU_XPU_PRT0_CNTL0_ADDR A:0x679b1258
y.create.l HWIO_QPIC_QPIC_MPU_XPU_PRT1_CNTL0_ADDR A:0x679b12d8
y.create.l HWIO_QPIC_QPIC_MPU_XPU_PRT2_CNTL0_ADDR A:0x679b1358
y.create.l HWIO_QPIC_QPIC_MPU_XPU_PRT3_CNTL0_ADDR A:0x679b13d8
y.create.l HWIO_QPIC_QPIC_MPU_XPU_PRT4_CNTL0_ADDR A:0x679b1458
y.create.l HWIO_QPIC_QPIC_MPU_XPU_PRT5_CNTL0_ADDR A:0x679b14d8
y.create.l HWIO_QPIC_QPIC_MPU_XPU_PRT6_CNTL0_ADDR A:0x679b1558
y.create.l HWIO_QPIC_QPIC_MPU_XPU_PRT7_CNTL0_ADDR A:0x679b15d8
y.create.l HWIO_QPIC_QPIC_MPU_XPU_PRT0_CNTL1_ADDR A:0x679b125c
y.create.l HWIO_QPIC_QPIC_MPU_XPU_PRT1_CNTL1_ADDR A:0x679b12dc
y.create.l HWIO_QPIC_QPIC_MPU_XPU_PRT2_CNTL1_ADDR A:0x679b135c
y.create.l HWIO_QPIC_QPIC_MPU_XPU_PRT3_CNTL1_ADDR A:0x679b13dc
y.create.l HWIO_QPIC_QPIC_MPU_XPU_PRT4_CNTL1_ADDR A:0x679b145c
y.create.l HWIO_QPIC_QPIC_MPU_XPU_PRT5_CNTL1_ADDR A:0x679b14dc
y.create.l HWIO_QPIC_QPIC_MPU_XPU_PRT6_CNTL1_ADDR A:0x679b155c
y.create.l HWIO_QPIC_QPIC_MPU_XPU_PRT7_CNTL1_ADDR A:0x679b15dc
y.create.l HWIO_RBCPR_VERSION_ADDR A:0x60048000
y.create.l HWIO_RBCPR_SENSOR_MASK0_ADDR A:0x60048020
y.create.l HWIO_RBCPR_SENSOR_MASK1_ADDR A:0x60048024
y.create.l HWIO_RBCPR_SENSOR_MASK2_ADDR A:0x60048028
y.create.l HWIO_RBCPR_SENSOR_MASK3_ADDR A:0x6004802c
y.create.l HWIO_RBCPR_SENSOR_BYPASS0_ADDR A:0x60048030
y.create.l HWIO_RBCPR_SENSOR_BYPASS1_ADDR A:0x60048034
y.create.l HWIO_RBCPR_SENSOR_BYPASS2_ADDR A:0x60048038
y.create.l HWIO_RBCPR_SENSOR_BYPASS3_ADDR A:0x6004803c
y.create.l HWIO_RBIF_PMIC_ADDR_ADDR A:0x60048040
y.create.l HWIO_RBCPR_TIMER_INTERVAL_ADDR A:0x60048044
y.create.l HWIO_RBIF_LIMIT_ADDR A:0x60048048
y.create.l HWIO_RBIF_TIMER_ADJUST_ADDR A:0x6004804c
y.create.l HWIO_RBCPR_GCNT_TARGET0_ADDR A:0x60048060
y.create.l HWIO_RBCPR_GCNT_TARGET1_ADDR A:0x60048064
y.create.l HWIO_RBCPR_GCNT_TARGET2_ADDR A:0x60048068
y.create.l HWIO_RBCPR_GCNT_TARGET3_ADDR A:0x6004806c
y.create.l HWIO_RBCPR_GCNT_TARGET4_ADDR A:0x60048070
y.create.l HWIO_RBCPR_GCNT_TARGET5_ADDR A:0x60048074
y.create.l HWIO_RBCPR_GCNT_TARGET6_ADDR A:0x60048078
y.create.l HWIO_RBCPR_GCNT_TARGET7_ADDR A:0x6004807c
y.create.l HWIO_RBCPR_STEP_QUOT_ADDR A:0x60048080
y.create.l HWIO_RBCPR_CTL_ADDR A:0x60048090
y.create.l HWIO_RBIF_SW_VLEVEL_ADDR A:0x60048094
y.create.l HWIO_RBIF_CONT_ACK_CMD_ADDR A:0x60048098
y.create.l HWIO_RBIF_CONT_NACK_CMD_ADDR A:0x6004809c
y.create.l HWIO_RBCPR_RESULT_0_ADDR A:0x600480a0
y.create.l HWIO_RBCPR_RESULT_1_ADDR A:0x600480a4
y.create.l HWIO_RBIF_IRQ_EN_0_ADDR A:0x60048100
y.create.l HWIO_RBIF_IRQ_EN_1_ADDR A:0x60048104
y.create.l HWIO_RBIF_IRQ_EN_2_ADDR A:0x60048108
y.create.l HWIO_RBIF_IRQ_CLEAR_ADDR A:0x60048110
y.create.l HWIO_RBIF_IRQ_STATUS_ADDR A:0x60048114
y.create.l HWIO_RBCPR_QUOT_AVG_ADDR A:0x60048118
y.create.l HWIO_RBCPR_DEBUG0_ADDR A:0x6004811c
y.create.l HWIO_RBCPR_DEBUG1_ADDR A:0x60048120
y.create.l HWIO_RBCPR_DEBUG2_ADDR A:0x60048124
y.create.l HWIO_RBCPR_BIST_MINMAX_ADDR A:0x60048128
y.create.l HWIO_RBCPR_BIST_RESULT_ADDR A:0x6004812c
y.create.l HWIO_RBCPR_BIST_FAIL_MAP0_ADDR A:0x60048130
y.create.l HWIO_RBCPR_BIST_FAIL_MAP1_ADDR A:0x60048134
y.create.l HWIO_RBCPR_BIST_FAIL_MAP2_ADDR A:0x60048138
y.create.l HWIO_RBCPR_BIST_FAIL_MAP3_ADDR A:0x6004813c
y.create.l HWIO_RBCPR_LOG_0_ADDR A:0x60048140
y.create.l HWIO_RBCPR_LOG_1_ADDR A:0x60048144
y.create.l HWIO_RBCPR_LOG_2_ADDR A:0x60048148
y.create.l HWIO_RBCPR_LOG_3_ADDR A:0x6004814c
y.create.l HWIO_RBCPR_LOG_4_ADDR A:0x60048150
y.create.l HWIO_RBCPR_LOG_5_ADDR A:0x60048154
y.create.l HWIO_RBCPR_LOG_6_ADDR A:0x60048158
y.create.l HWIO_RBCPR_LOG_7_ADDR A:0x6004815c
y.create.l HWIO_RBCPR_HTOL_AGE_ADDR A:0x60048160
y.create.l HWIO_RPM_HW_VERSION_ADDR A:0x80000
y.create.l HWIO_RPM_WFI_CONFIG_ADDR A:0x80004
y.create.l HWIO_RPM_TIMERS_CLK_OFF_CTL_ADDR A:0x80008
y.create.l HWIO_RPM_IPC_ADDR A:0x8000c
y.create.l HWIO_RPM_GPO_WDATA_ADDR A:0x80010
y.create.l HWIO_RPM_GPO_WDSET_ADDR A:0x80014
y.create.l HWIO_RPM_GPO_WDCLR_ADDR A:0x80018
y.create.l HWIO_RPM_SLAVES_CLK_GATING_ADDR A:0x8001c
y.create.l HWIO_RPM_INTR_POLARITY_0_ADDR A:0x80030
y.create.l HWIO_RPM_INTR_POLARITY_1_ADDR A:0x80034
y.create.l HWIO_RPM_INTR_EDG_LVL_0_ADDR A:0x80038
y.create.l HWIO_RPM_INTR_EDG_LVL_1_ADDR A:0x8003c
y.create.l HWIO_RPM_WDOG_RESET_ADDR A:0x80040
y.create.l HWIO_RPM_WDOG_CTRL_ADDR A:0x80044
y.create.l HWIO_RPM_WDOG_STATUS_ADDR A:0x80048
y.create.l HWIO_RPM_WDOG_BARK_TIME_ADDR A:0x8004c
y.create.l HWIO_RPM_WDOG_BITE_TIME_ADDR A:0x80050
y.create.l HWIO_RPM_WDOG_TEST_LOAD_ADDR A:0x80054
y.create.l HWIO_RPM_WDOG_TEST_ADDR A:0x80058
y.create.l HWIO_RPM_TEST_BUS_SEL_ADDR A:0x8005c
y.create.l HWIO_RPM_SPARE_REG0_ADDR A:0x80060
y.create.l HWIO_RPM_SPARE_REG1_ADDR A:0x80064
y.create.l HWIO_RPM_SPARE_REG2_ADDR A:0x80068
y.create.l HWIO_RPM_SPARE_REG3_ADDR A:0x8006c
y.create.l HWIO_RPM_PAGE_SELECT_ADDR A:0x80070
y.create.l HWIO_RPM_QTMR_AC_CNTFRQ_ADDR A:0x82000
y.create.l HWIO_RPM_QTMR_AC_CNTSR_ADDR A:0x82004
y.create.l HWIO_RPM_QTMR_AC_CNTTID_ADDR A:0x82008
y.create.l HWIO_RPM_QTMR_AC_CNTACR_0_ADDR A:0x82040
y.create.l HWIO_RPM_QTMR_AC_CNTACR_1_ADDR A:0x82044
y.create.l HWIO_RPM_QTMR_AC_CNTVOFF_LO_0_ADDR A:0x82080
y.create.l HWIO_RPM_QTMR_AC_CNTVOFF_LO_1_ADDR A:0x82088
y.create.l HWIO_RPM_QTMR_AC_CNTVOFF_HI_0_ADDR A:0x82084
y.create.l HWIO_RPM_QTMR_AC_CNTVOFF_HI_1_ADDR A:0x8208c
y.create.l HWIO_RPM_QTMR_AC_CFG_ADDR A:0x82fc0
y.create.l HWIO_RPM_QTMR_AC_VERSION_ADDR A:0x82fd0
y.create.l HWIO_RPM_F0_QTMR_V1_CNTPCT_LO_ADDR A:0x83000
y.create.l HWIO_RPM_F0_QTMR_V1_CNTPCT_HI_ADDR A:0x83004
y.create.l HWIO_RPM_F0_QTMR_V1_CNTVCT_LO_ADDR A:0x83008
y.create.l HWIO_RPM_F0_QTMR_V1_CNTVCT_HI_ADDR A:0x8300c
y.create.l HWIO_RPM_F0_QTMR_V1_CNTFRQ_ADDR A:0x83010
y.create.l HWIO_RPM_F0_QTMR_V1_CNTPL0ACR_ADDR A:0x83014
y.create.l HWIO_RPM_F0_QTMR_V1_CNTVOFF_LO_ADDR A:0x83018
y.create.l HWIO_RPM_F0_QTMR_V1_CNTVOFF_HI_ADDR A:0x8301c
y.create.l HWIO_RPM_F0_QTMR_V1_CNTP_CVAL_LO_ADDR A:0x83020
y.create.l HWIO_RPM_F0_QTMR_V1_CNTP_CVAL_HI_ADDR A:0x83024
y.create.l HWIO_RPM_F0_QTMR_V1_CNTP_TVAL_ADDR A:0x83028
y.create.l HWIO_RPM_F0_QTMR_V1_CNTP_CTL_ADDR A:0x8302c
y.create.l HWIO_RPM_F0_QTMR_V1_CNTV_CVAL_LO_ADDR A:0x83030
y.create.l HWIO_RPM_F0_QTMR_V1_CNTV_CVAL_HI_ADDR A:0x83034
y.create.l HWIO_RPM_F0_QTMR_V1_CNTV_TVAL_ADDR A:0x83038
y.create.l HWIO_RPM_F0_QTMR_V1_CNTV_CTL_ADDR A:0x8303c
y.create.l HWIO_RPM_F0_QTMR_V1_VERSION_ADDR A:0x83fd0
y.create.l HWIO_RPM_F1_QTMR_V1_CNTPCT_LO_ADDR A:0x84000
y.create.l HWIO_RPM_F1_QTMR_V1_CNTPCT_HI_ADDR A:0x84004
y.create.l HWIO_RPM_F1_QTMR_V1_CNTVCT_LO_ADDR A:0x84008
y.create.l HWIO_RPM_F1_QTMR_V1_CNTVCT_HI_ADDR A:0x8400c
y.create.l HWIO_RPM_F1_QTMR_V1_CNTFRQ_ADDR A:0x84010
y.create.l HWIO_RPM_F1_QTMR_V1_CNTPL0ACR_ADDR A:0x84014
y.create.l HWIO_RPM_F1_QTMR_V1_CNTVOFF_LO_ADDR A:0x84018
y.create.l HWIO_RPM_F1_QTMR_V1_CNTVOFF_HI_ADDR A:0x8401c
y.create.l HWIO_RPM_F1_QTMR_V1_CNTP_CVAL_LO_ADDR A:0x84020
y.create.l HWIO_RPM_F1_QTMR_V1_CNTP_CVAL_HI_ADDR A:0x84024
y.create.l HWIO_RPM_F1_QTMR_V1_CNTP_TVAL_ADDR A:0x84028
y.create.l HWIO_RPM_F1_QTMR_V1_CNTP_CTL_ADDR A:0x8402c
y.create.l HWIO_RPM_F1_QTMR_V1_CNTV_CVAL_LO_ADDR A:0x84030
y.create.l HWIO_RPM_F1_QTMR_V1_CNTV_CVAL_HI_ADDR A:0x84034
y.create.l HWIO_RPM_F1_QTMR_V1_CNTV_TVAL_ADDR A:0x84038
y.create.l HWIO_RPM_F1_QTMR_V1_CNTV_CTL_ADDR A:0x8403c
y.create.l HWIO_RPM_F1_QTMR_V1_VERSION_ADDR A:0x84fd0
y.create.l HWIO_RPM_APU_XPU_SCR_ADDR A:0x87000
y.create.l HWIO_RPM_APU_XPU_SWDR_ADDR A:0x87004
y.create.l HWIO_RPM_APU_XPU_SEAR0_ADDR A:0x87040
y.create.l HWIO_RPM_APU_XPU_SESR_ADDR A:0x87048
y.create.l HWIO_RPM_APU_XPU_SESRRESTORE_ADDR A:0x8704c
y.create.l HWIO_RPM_APU_XPU_SESYNR0_ADDR A:0x87050
y.create.l HWIO_RPM_APU_XPU_SESYNR1_ADDR A:0x87054
y.create.l HWIO_RPM_APU_XPU_SESYNR2_ADDR A:0x87058
y.create.l HWIO_RPM_APU_XPU_MCR_ADDR A:0x87100
y.create.l HWIO_RPM_APU_XPU_MEAR0_ADDR A:0x87140
y.create.l HWIO_RPM_APU_XPU_MESR_ADDR A:0x87148
y.create.l HWIO_RPM_APU_XPU_MESRRESTORE_ADDR A:0x8714c
y.create.l HWIO_RPM_APU_XPU_MESYNR0_ADDR A:0x87150
y.create.l HWIO_RPM_APU_XPU_MESYNR1_ADDR A:0x87154
y.create.l HWIO_RPM_APU_XPU_MESYNR2_ADDR A:0x87158
y.create.l HWIO_RPM_APU_XPU_CR_ADDR A:0x87080
y.create.l HWIO_RPM_APU_XPU_RPU_ACR0_ADDR A:0x870a0
y.create.l HWIO_RPM_APU_XPU_EAR0_ADDR A:0x870c0
y.create.l HWIO_RPM_APU_XPU_ESR_ADDR A:0x870c8
y.create.l HWIO_RPM_APU_XPU_ESRRESTORE_ADDR A:0x870cc
y.create.l HWIO_RPM_APU_XPU_ESYNR0_ADDR A:0x870d0
y.create.l HWIO_RPM_APU_XPU_ESYNR1_ADDR A:0x870d4
y.create.l HWIO_RPM_APU_XPU_ESYNR2_ADDR A:0x870d8
y.create.l HWIO_RPM_APU_XPU_IDR0_ADDR A:0x87074
y.create.l HWIO_RPM_APU_XPU_IDR1_ADDR A:0x87078
y.create.l HWIO_RPM_APU_XPU_REV_ADDR A:0x8707c
y.create.l HWIO_RPM_APU_XPU_RG0_RACR0_ADDR A:0x87200
y.create.l HWIO_RPM_APU_XPU_RG1_RACR0_ADDR A:0x87280
y.create.l HWIO_RPM_APU_XPU_RG0_WACR0_ADDR A:0x87220
y.create.l HWIO_RPM_APU_XPU_RG1_WACR0_ADDR A:0x872a0
y.create.l HWIO_RPM_APU_XPU_RG0_SCR_ADDR A:0x87250
y.create.l HWIO_RPM_APU_XPU_RG1_SCR_ADDR A:0x872d0
y.create.l HWIO_RPM_APU_XPU_RG0_MCR_ADDR A:0x87254
y.create.l HWIO_RPM_APU_XPU_RG1_MCR_ADDR A:0x872d4
y.create.l HWIO_RPM_VMIDMT_SCR0_ADDR A:0x88000
y.create.l HWIO_RPM_VMIDMT_SCR1_ADDR A:0x88004
y.create.l HWIO_RPM_VMIDMT_SCR2_ADDR A:0x88008
y.create.l HWIO_RPM_VMIDMT_SACR_ADDR A:0x88010
y.create.l HWIO_RPM_VMIDMT_SIDR0_ADDR A:0x88020
y.create.l HWIO_RPM_VMIDMT_SIDR1_ADDR A:0x88024
y.create.l HWIO_RPM_VMIDMT_SIDR2_ADDR A:0x88028
y.create.l HWIO_RPM_VMIDMT_SIDR4_ADDR A:0x88030
y.create.l HWIO_RPM_VMIDMT_SIDR5_ADDR A:0x88034
y.create.l HWIO_RPM_VMIDMT_SIDR7_ADDR A:0x8803c
y.create.l HWIO_RPM_VMIDMT_SGFAR0_ADDR A:0x88040
y.create.l HWIO_RPM_VMIDMT_SGFSR_ADDR A:0x88048
y.create.l HWIO_RPM_VMIDMT_SGFSRRESTORE_ADDR A:0x8804c
y.create.l HWIO_RPM_VMIDMT_SGFSYNDR0_ADDR A:0x88050
y.create.l HWIO_RPM_VMIDMT_SGFSYNDR1_ADDR A:0x88054
y.create.l HWIO_RPM_VMIDMT_SGFSYNDR2_ADDR A:0x88058
y.create.l HWIO_RPM_VMIDMT_VMIDMTSCR0_ADDR A:0x88090
y.create.l HWIO_RPM_VMIDMT_CR0_ADDR A:0x88000
y.create.l HWIO_RPM_VMIDMT_CR2_ADDR A:0x88008
y.create.l HWIO_RPM_VMIDMT_ACR_ADDR A:0x88010
y.create.l HWIO_RPM_VMIDMT_IDR0_ADDR A:0x88020
y.create.l HWIO_RPM_VMIDMT_IDR1_ADDR A:0x88024
y.create.l HWIO_RPM_VMIDMT_IDR2_ADDR A:0x88028
y.create.l HWIO_RPM_VMIDMT_IDR4_ADDR A:0x88030
y.create.l HWIO_RPM_VMIDMT_IDR5_ADDR A:0x88034
y.create.l HWIO_RPM_VMIDMT_IDR7_ADDR A:0x8803c
y.create.l HWIO_RPM_VMIDMT_GFAR0_ADDR A:0x88040
y.create.l HWIO_RPM_VMIDMT_GFSR_ADDR A:0x88048
y.create.l HWIO_RPM_VMIDMT_GFSRRESTORE_ADDR A:0x8804c
y.create.l HWIO_RPM_VMIDMT_GFSYNDR0_ADDR A:0x88050
y.create.l HWIO_RPM_VMIDMT_GFSYNDR1_ADDR A:0x88054
y.create.l HWIO_RPM_VMIDMT_GFSYNDR2_ADDR A:0x88058
y.create.l HWIO_RPM_VMIDMT_VMIDMTCR0_ADDR A:0x88090
y.create.l HWIO_RPM_VMIDMT_VMIDMTACR_ADDR A:0x8809c
y.create.l HWIO_RPM_VMIDMT_NSCR0_ADDR A:0x88400
y.create.l HWIO_RPM_VMIDMT_NSCR2_ADDR A:0x88408
y.create.l HWIO_RPM_VMIDMT_NSACR_ADDR A:0x88410
y.create.l HWIO_RPM_VMIDMT_NSGFAR0_ADDR A:0x88440
y.create.l HWIO_RPM_VMIDMT_NSGFSR_ADDR A:0x88448
y.create.l HWIO_RPM_VMIDMT_NSGFSRRESTORE_ADDR A:0x8844c
y.create.l HWIO_RPM_VMIDMT_NSGFSYNDR0_ADDR A:0x88450
y.create.l HWIO_RPM_VMIDMT_NSGFSYNDR1_ADDR A:0x88454
y.create.l HWIO_RPM_VMIDMT_NSGFSYNDR2_ADDR A:0x88458
y.create.l HWIO_RPM_VMIDMT_NSVMIDMTCR0_ADDR A:0x88490
y.create.l HWIO_RPM_VMIDMT_SSDR0_ADDR A:0x88080
y.create.l HWIO_RPM_VMIDMT_MSDR0_ADDR A:0x88480
y.create.l HWIO_RPM_VMIDMT_MCR_ADDR A:0x88494
y.create.l HWIO_RPM_VMIDMT_S2VR0_ADDR A:0x88c00
y.create.l HWIO_RPM_VMIDMT_AS2VR0_ADDR A:0x88e00
y.create.l HWIO_RPM_M3_ITM_ITM_STIM0_ADDR A:0xe0000000
y.create.l HWIO_RPM_M3_ITM_ITM_STIM1_ADDR A:0xe0000004
y.create.l HWIO_RPM_M3_ITM_ITM_STIM2_ADDR A:0xe0000008
y.create.l HWIO_RPM_M3_ITM_ITM_STIM3_ADDR A:0xe000000c
y.create.l HWIO_RPM_M3_ITM_ITM_STIM4_ADDR A:0xe0000010
y.create.l HWIO_RPM_M3_ITM_ITM_STIM5_ADDR A:0xe0000014
y.create.l HWIO_RPM_M3_ITM_ITM_STIM6_ADDR A:0xe0000018
y.create.l HWIO_RPM_M3_ITM_ITM_STIM7_ADDR A:0xe000001c
y.create.l HWIO_RPM_M3_ITM_ITM_STIM8_ADDR A:0xe0000020
y.create.l HWIO_RPM_M3_ITM_ITM_STIM9_ADDR A:0xe0000024
y.create.l HWIO_RPM_M3_ITM_ITM_STIM10_ADDR A:0xe0000028
y.create.l HWIO_RPM_M3_ITM_ITM_STIM11_ADDR A:0xe000002c
y.create.l HWIO_RPM_M3_ITM_ITM_STIM12_ADDR A:0xe0000030
y.create.l HWIO_RPM_M3_ITM_ITM_STIM13_ADDR A:0xe0000034
y.create.l HWIO_RPM_M3_ITM_ITM_STIM14_ADDR A:0xe0000038
y.create.l HWIO_RPM_M3_ITM_ITM_STIM15_ADDR A:0xe000003c
y.create.l HWIO_RPM_M3_ITM_ITM_STIM16_ADDR A:0xe0000040
y.create.l HWIO_RPM_M3_ITM_ITM_STIM17_ADDR A:0xe0000044
y.create.l HWIO_RPM_M3_ITM_ITM_STIM18_ADDR A:0xe0000048
y.create.l HWIO_RPM_M3_ITM_ITM_STIM19_ADDR A:0xe000004c
y.create.l HWIO_RPM_M3_ITM_ITM_STIM20_ADDR A:0xe0000050
y.create.l HWIO_RPM_M3_ITM_ITM_STIM21_ADDR A:0xe0000054
y.create.l HWIO_RPM_M3_ITM_ITM_STIM22_ADDR A:0xe0000058
y.create.l HWIO_RPM_M3_ITM_ITM_STIM23_ADDR A:0xe000005c
y.create.l HWIO_RPM_M3_ITM_ITM_STIM24_ADDR A:0xe0000060
y.create.l HWIO_RPM_M3_ITM_ITM_STIM25_ADDR A:0xe0000064
y.create.l HWIO_RPM_M3_ITM_ITM_STIM26_ADDR A:0xe0000068
y.create.l HWIO_RPM_M3_ITM_ITM_STIM27_ADDR A:0xe000006c
y.create.l HWIO_RPM_M3_ITM_ITM_STIM28_ADDR A:0xe0000070
y.create.l HWIO_RPM_M3_ITM_ITM_STIM29_ADDR A:0xe0000074
y.create.l HWIO_RPM_M3_ITM_ITM_STIM30_ADDR A:0xe0000078
y.create.l HWIO_RPM_M3_ITM_ITM_STIM31_ADDR A:0xe000007c
y.create.l HWIO_RPM_M3_ITM_ITM_TER_ADDR A:0xe0000e00
y.create.l HWIO_RPM_M3_ITM_ITM_TPR_ADDR A:0xe0000e40
y.create.l HWIO_RPM_M3_ITM_ITM_TCR_ADDR A:0xe0000e80
y.create.l HWIO_RPM_M3_ITM_ITM_IWR_ADDR A:0xe0000ef8
y.create.l HWIO_RPM_M3_ITM_ITM_IMCR_ADDR A:0xe0000f00
y.create.l HWIO_RPM_M3_ITM_ITM_LAR_ADDR A:0xe0000fb0
y.create.l HWIO_RPM_M3_ITM_ITM_LSR_ADDR A:0xe0000fb4
y.create.l HWIO_RPM_M3_ITM_PID4_ADDR A:0xe0000fd0
y.create.l HWIO_RPM_M3_ITM_PID5_ADDR A:0xe0000fd4
y.create.l HWIO_RPM_M3_ITM_PID6_ADDR A:0xe0000fd8
y.create.l HWIO_RPM_M3_ITM_PID7_ADDR A:0xe0000fdc
y.create.l HWIO_RPM_M3_ITM_PID0_ADDR A:0xe0000fe0
y.create.l HWIO_RPM_M3_ITM_PID1_ADDR A:0xe0000fe4
y.create.l HWIO_RPM_M3_ITM_PID2_ADDR A:0xe0000fe8
y.create.l HWIO_RPM_M3_ITM_PID3_ADDR A:0xe0000fec
y.create.l HWIO_RPM_M3_ITM_CID0_ADDR A:0xe0000ff0
y.create.l HWIO_RPM_M3_ITM_CID1_ADDR A:0xe0000ff4
y.create.l HWIO_RPM_M3_ITM_CID2_ADDR A:0xe0000ff8
y.create.l HWIO_RPM_M3_ITM_CID3_ADDR A:0xe0000ffc
y.create.l HWIO_RPM_M3_DWT_DWT_CTRL_ADDR A:0xe0001000
y.create.l HWIO_RPM_M3_DWT_DWT_CYCCNT_ADDR A:0xe0001004
y.create.l HWIO_RPM_M3_DWT_DWT_CPICNT_ADDR A:0xe0001008
y.create.l HWIO_RPM_M3_DWT_DWT_EXCCNT_ADDR A:0xe000100c
y.create.l HWIO_RPM_M3_DWT_DWT_SLEEPCNT_ADDR A:0xe0001010
y.create.l HWIO_RPM_M3_DWT_DWT_LSUCNT_ADDR A:0xe0001014
y.create.l HWIO_RPM_M3_DWT_DWT_FOLDCNT_ADDR A:0xe0001018
y.create.l HWIO_RPM_M3_DWT_DWT_PCSR_ADDR A:0xe000101c
y.create.l HWIO_RPM_M3_DWT_DWT_COMP0_ADDR A:0xe0001020
y.create.l HWIO_RPM_M3_DWT_DWT_MASK0_ADDR A:0xe0001024
y.create.l HWIO_RPM_M3_DWT_DWT_FUNCTION0_ADDR A:0xe0001028
y.create.l HWIO_RPM_M3_DWT_DWT_COMP1_ADDR A:0xe0001030
y.create.l HWIO_RPM_M3_DWT_DWT_MASK1_ADDR A:0xe0001034
y.create.l HWIO_RPM_M3_DWT_DWT_FUNCTION1_ADDR A:0xe0001038
y.create.l HWIO_RPM_M3_DWT_DWT_COMP2_ADDR A:0xe0001040
y.create.l HWIO_RPM_M3_DWT_DWT_MASK2_ADDR A:0xe0001044
y.create.l HWIO_RPM_M3_DWT_DWT_FUNCTION2_ADDR A:0xe0001048
y.create.l HWIO_RPM_M3_DWT_DWT_COMP3_ADDR A:0xe0001050
y.create.l HWIO_RPM_M3_DWT_DWT_MASK3_ADDR A:0xe0001054
y.create.l HWIO_RPM_M3_DWT_DWT_FUNCTION3_ADDR A:0xe0001058
y.create.l HWIO_RPM_M3_DWT_PID4_ADDR A:0xe0001fd0
y.create.l HWIO_RPM_M3_DWT_PID5_ADDR A:0xe0001fd4
y.create.l HWIO_RPM_M3_DWT_PID6_ADDR A:0xe0001fd8
y.create.l HWIO_RPM_M3_DWT_PID7_ADDR A:0xe0001fdc
y.create.l HWIO_RPM_M3_DWT_PID0_ADDR A:0xe0001fe0
y.create.l HWIO_RPM_M3_DWT_PID1_ADDR A:0xe0001fe4
y.create.l HWIO_RPM_M3_DWT_PID2_ADDR A:0xe0001fe8
y.create.l HWIO_RPM_M3_DWT_PID3_ADDR A:0xe0001fec
y.create.l HWIO_RPM_M3_DWT_CID0_ADDR A:0xe0001ff0
y.create.l HWIO_RPM_M3_DWT_CID1_ADDR A:0xe0001ff4
y.create.l HWIO_RPM_M3_DWT_CID2_ADDR A:0xe0001ff8
y.create.l HWIO_RPM_M3_DWT_CID3_ADDR A:0xe0001ffc
y.create.l HWIO_RPM_M3_FPB_FP_CTRL_ADDR A:0xe0002000
y.create.l HWIO_RPM_M3_FPB_FP_REMAP_ADDR A:0xe0002004
y.create.l HWIO_RPM_M3_FPB_FP_COMP0_ADDR A:0xe0002008
y.create.l HWIO_RPM_M3_FPB_FP_COMP1_ADDR A:0xe000200c
y.create.l HWIO_RPM_M3_FPB_FP_COMP2_ADDR A:0xe0002010
y.create.l HWIO_RPM_M3_FPB_FP_COMP3_ADDR A:0xe0002014
y.create.l HWIO_RPM_M3_FPB_FP_COMP4_ADDR A:0xe0002018
y.create.l HWIO_RPM_M3_FPB_FP_COMP5_ADDR A:0xe000201c
y.create.l HWIO_RPM_M3_FPB_FP_COMP6_ADDR A:0xe0002020
y.create.l HWIO_RPM_M3_FPB_FP_COMP7_ADDR A:0xe0002024
y.create.l HWIO_RPM_M3_FPB_PID4_ADDR A:0xe0002fd0
y.create.l HWIO_RPM_M3_FPB_PID5_ADDR A:0xe0002fd4
y.create.l HWIO_RPM_M3_FPB_PID6_ADDR A:0xe0002fd8
y.create.l HWIO_RPM_M3_FPB_PID7_ADDR A:0xe0002fdc
y.create.l HWIO_RPM_M3_FPB_PID0_ADDR A:0xe0002fe0
y.create.l HWIO_RPM_M3_FPB_PID1_ADDR A:0xe0002fe4
y.create.l HWIO_RPM_M3_FPB_PID2_ADDR A:0xe0002fe8
y.create.l HWIO_RPM_M3_FPB_PID3_ADDR A:0xe0002fec
y.create.l HWIO_RPM_M3_FPB_CID0_ADDR A:0xe0002ff0
y.create.l HWIO_RPM_M3_FPB_CID1_ADDR A:0xe0002ff4
y.create.l HWIO_RPM_M3_FPB_CID2_ADDR A:0xe0002ff8
y.create.l HWIO_RPM_M3_FPB_CID3_ADDR A:0xe0002ffc
y.create.l HWIO_RPM_M3_SCS_ICTR_ADDR A:0xe000e004
y.create.l HWIO_RPM_M3_SCS_ACTLR_ADDR A:0xe000e008
y.create.l HWIO_RPM_M3_SCS_STCSR_ADDR A:0xe000e010
y.create.l HWIO_RPM_M3_SCS_STRVR_ADDR A:0xe000e014
y.create.l HWIO_RPM_M3_SCS_STCVR_ADDR A:0xe000e018
y.create.l HWIO_RPM_M3_SCS_STCR_ADDR A:0xe000e01c
y.create.l HWIO_RPM_M3_SCS_NVIC_ISER0_ADDR A:0xe000e100
y.create.l HWIO_RPM_M3_SCS_NVIC_ISER1_ADDR A:0xe000e104
y.create.l HWIO_RPM_M3_SCS_NVIC_ICER0_ADDR A:0xe000e180
y.create.l HWIO_RPM_M3_SCS_NVIC_ICER1_ADDR A:0xe000e184
y.create.l HWIO_RPM_M3_SCS_NVIC_ISPR0_ADDR A:0xe000e200
y.create.l HWIO_RPM_M3_SCS_NVIC_ISPR1_ADDR A:0xe000e204
y.create.l HWIO_RPM_M3_SCS_NVIC_ICPR0_ADDR A:0xe000e280
y.create.l HWIO_RPM_M3_SCS_NVIC_ICPR1_ADDR A:0xe000e284
y.create.l HWIO_RPM_M3_SCS_NVIC_IABR0_ADDR A:0xe000e300
y.create.l HWIO_RPM_M3_SCS_NVIC_IABR1_ADDR A:0xe000e304
y.create.l HWIO_RPM_M3_SCS_NVIC_IPR0_ADDR A:0xe000e400
y.create.l HWIO_RPM_M3_SCS_NVIC_IPR1_ADDR A:0xe000e404
y.create.l HWIO_RPM_M3_SCS_NVIC_IPR2_ADDR A:0xe000e408
y.create.l HWIO_RPM_M3_SCS_NVIC_IPR3_ADDR A:0xe000e40c
y.create.l HWIO_RPM_M3_SCS_NVIC_IPR4_ADDR A:0xe000e410
y.create.l HWIO_RPM_M3_SCS_NVIC_IPR5_ADDR A:0xe000e414
y.create.l HWIO_RPM_M3_SCS_NVIC_IPR6_ADDR A:0xe000e418
y.create.l HWIO_RPM_M3_SCS_NVIC_IPR7_ADDR A:0xe000e41c
y.create.l HWIO_RPM_M3_SCS_NVIC_IPR8_ADDR A:0xe000e420
y.create.l HWIO_RPM_M3_SCS_NVIC_IPR9_ADDR A:0xe000e424
y.create.l HWIO_RPM_M3_SCS_NVIC_IPR10_ADDR A:0xe000e428
y.create.l HWIO_RPM_M3_SCS_NVIC_IPR11_ADDR A:0xe000e42c
y.create.l HWIO_RPM_M3_SCS_NVIC_IPR12_ADDR A:0xe000e430
y.create.l HWIO_RPM_M3_SCS_NVIC_IPR13_ADDR A:0xe000e434
y.create.l HWIO_RPM_M3_SCS_NVIC_IPR14_ADDR A:0xe000e438
y.create.l HWIO_RPM_M3_SCS_NVIC_IPR15_ADDR A:0xe000e43c
y.create.l HWIO_RPM_M3_SCS_CPUID_ADDR A:0xe000ed00
y.create.l HWIO_RPM_M3_SCS_ICSR_ADDR A:0xe000ed04
y.create.l HWIO_RPM_M3_SCS_VTOR_ADDR A:0xe000ed08
y.create.l HWIO_RPM_M3_SCS_AIRCR_ADDR A:0xe000ed0c
y.create.l HWIO_RPM_M3_SCS_SCR_ADDR A:0xe000ed10
y.create.l HWIO_RPM_M3_SCS_CCR_ADDR A:0xe000ed14
y.create.l HWIO_RPM_M3_SCS_SHPR1_ADDR A:0xe000ed18
y.create.l HWIO_RPM_M3_SCS_SHPR2_ADDR A:0xe000ed1c
y.create.l HWIO_RPM_M3_SCS_SHPR3_ADDR A:0xe000ed20
y.create.l HWIO_RPM_M3_SCS_SHCSR_ADDR A:0xe000ed24
y.create.l HWIO_RPM_M3_SCS_CFSR_ADDR A:0xe000ed28
y.create.l HWIO_RPM_M3_SCS_HFSR_ADDR A:0xe000ed2c
y.create.l HWIO_RPM_M3_SCS_DFSR_ADDR A:0xe000ed30
y.create.l HWIO_RPM_M3_SCS_MMFAR_ADDR A:0xe000ed34
y.create.l HWIO_RPM_M3_SCS_BFAR_ADDR A:0xe000ed38
y.create.l HWIO_RPM_M3_SCS_AFSR_ADDR A:0xe000ed3c
y.create.l HWIO_RPM_M3_SCS_ID_PFR0_ADDR A:0xe000ed40
y.create.l HWIO_RPM_M3_SCS_ID_PFR1_ADDR A:0xe000ed44
y.create.l HWIO_RPM_M3_SCS_ID_DFR0_ADDR A:0xe000ed48
y.create.l HWIO_RPM_M3_SCS_ID_AFR0_ADDR A:0xe000ed4c
y.create.l HWIO_RPM_M3_SCS_ID_MMFR0_ADDR A:0xe000ed50
y.create.l HWIO_RPM_M3_SCS_ID_MMFR1_ADDR A:0xe000ed54
y.create.l HWIO_RPM_M3_SCS_ID_MMFR2_ADDR A:0xe000ed58
y.create.l HWIO_RPM_M3_SCS_ID_MMFR3_ADDR A:0xe000ed5c
y.create.l HWIO_RPM_M3_SCS_ID_ISAR0_ADDR A:0xe000ed60
y.create.l HWIO_RPM_M3_SCS_ID_ISAR1_ADDR A:0xe000ed64
y.create.l HWIO_RPM_M3_SCS_ID_ISAR2_ADDR A:0xe000ed68
y.create.l HWIO_RPM_M3_SCS_ID_ISAR3_ADDR A:0xe000ed6c
y.create.l HWIO_RPM_M3_SCS_ID_ISAR4_ADDR A:0xe000ed70
y.create.l HWIO_RPM_M3_SCS_CPACR_ADDR A:0xe000ed88
y.create.l HWIO_RPM_M3_SCS_MPU_TYPE_ADDR A:0xe000ed90
y.create.l HWIO_RPM_M3_SCS_MPU_CTRL_ADDR A:0xe000ed94
y.create.l HWIO_RPM_M3_SCS_MPU_RNR_ADDR A:0xe000ed98
y.create.l HWIO_RPM_M3_SCS_MPU_RBAR_ADDR A:0xe000ed9c
y.create.l HWIO_RPM_M3_SCS_MPU_RASR_ADDR A:0xe000eda0
y.create.l HWIO_RPM_M3_SCS_MPU_RBAR_A1_ADDR A:0xe000eda4
y.create.l HWIO_RPM_M3_SCS_MPU_RASR_A1_ADDR A:0xe000eda8
y.create.l HWIO_RPM_M3_SCS_MPU_RBAR_A2_ADDR A:0xe000edac
y.create.l HWIO_RPM_M3_SCS_MPU_RASR_A2_ADDR A:0xe000edb0
y.create.l HWIO_RPM_M3_SCS_MPU_RBAR_A3_ADDR A:0xe000edb4
y.create.l HWIO_RPM_M3_SCS_MPU_RASR_A3_ADDR A:0xe000edb8
y.create.l HWIO_RPM_M3_SCS_DHCSR_ADDR A:0xe000edf0
y.create.l HWIO_RPM_M3_SCS_DCRSR_ADDR A:0xe000edf4
y.create.l HWIO_RPM_M3_SCS_DCRDR_ADDR A:0xe000edf8
y.create.l HWIO_RPM_M3_SCS_DEMCR_ADDR A:0xe000edfc
y.create.l HWIO_RPM_M3_SCS_STIR_ADDR A:0xe000ef00
y.create.l HWIO_RPM_M3_SCS_PID4_ADDR A:0xe000efd0
y.create.l HWIO_RPM_M3_SCS_PID5_ADDR A:0xe000efd4
y.create.l HWIO_RPM_M3_SCS_PID6_ADDR A:0xe000efd8
y.create.l HWIO_RPM_M3_SCS_PID7_ADDR A:0xe000efdc
y.create.l HWIO_RPM_M3_SCS_PID0_ADDR A:0xe000efe0
y.create.l HWIO_RPM_M3_SCS_PID1_ADDR A:0xe000efe4
y.create.l HWIO_RPM_M3_SCS_PID2_ADDR A:0xe000efe8
y.create.l HWIO_RPM_M3_SCS_PID3_ADDR A:0xe000efec
y.create.l HWIO_RPM_M3_SCS_CID0_ADDR A:0xe000eff0
y.create.l HWIO_RPM_M3_SCS_CID1_ADDR A:0xe000eff4
y.create.l HWIO_RPM_M3_SCS_CID2_ADDR A:0xe000eff8
y.create.l HWIO_RPM_M3_SCS_CID3_ADDR A:0xe000effc
y.create.l HWIO_RPM_M3_ETM_ETMCR_ADDR A:0xe0041000
y.create.l HWIO_RPM_M3_ETM_ETMCCR_ADDR A:0xe0041004
y.create.l HWIO_RPM_M3_ETM_ETMTRIGGER_ADDR A:0xe0041008
y.create.l HWIO_RPM_M3_ETM_ETMSR_ADDR A:0xe0041010
y.create.l HWIO_RPM_M3_ETM_ETMSCR_ADDR A:0xe0041014
y.create.l HWIO_RPM_M3_ETM_ETMTEEVR_ADDR A:0xe0041020
y.create.l HWIO_RPM_M3_ETM_ETMTECR1_ADDR A:0xe0041024
y.create.l HWIO_RPM_M3_ETM_ETMFFLR_ADDR A:0xe0041028
y.create.l HWIO_RPM_M3_ETM_ETMCNTRLDVR1_ADDR A:0xe0041140
y.create.l HWIO_RPM_M3_ETM_ETMSYNCFR_ADDR A:0xe00411e0
y.create.l HWIO_RPM_M3_ETM_ETMIDR_ADDR A:0xe00411e4
y.create.l HWIO_RPM_M3_ETM_ETMCCER_ADDR A:0xe00411e8
y.create.l HWIO_RPM_M3_ETM_ETMTESSEICR_ADDR A:0xe00411f0
y.create.l HWIO_RPM_M3_ETM_ETMTSEVR_ADDR A:0xe00411f8
y.create.l HWIO_RPM_M3_ETM_ETMTRACEIDR_ADDR A:0xe0041200
y.create.l HWIO_RPM_M3_ETM_ETMIDR2_ADDR A:0xe0041208
y.create.l HWIO_RPM_M3_ETM_ETMPDSR_ADDR A:0xe0041314
y.create.l HWIO_RPM_M3_ETM_ITMISCIN_ADDR A:0xe0041ee0
y.create.l HWIO_RPM_M3_ETM_ITTRIGOUT_ADDR A:0xe0041ee8
y.create.l HWIO_RPM_M3_ETM_ETM_ITATBCTR2_ADDR A:0xe0041ef0
y.create.l HWIO_RPM_M3_ETM_ETM_ITATBCTR0_ADDR A:0xe0041ef8
y.create.l HWIO_RPM_M3_ETM_ETMITCTRL_ADDR A:0xe0041f00
y.create.l HWIO_RPM_M3_ETM_ETMCLAIMSET_ADDR A:0xe0041fa0
y.create.l HWIO_RPM_M3_ETM_ETMCLAIMCLR_ADDR A:0xe0041fa4
y.create.l HWIO_RPM_M3_ETM_ETMLAR_ADDR A:0xe0041fb0
y.create.l HWIO_RPM_M3_ETM_ETMLSR_ADDR A:0xe0041fb4
y.create.l HWIO_RPM_M3_ETM_ETMAUTHSTATUS_ADDR A:0xe0041fb8
y.create.l HWIO_RPM_M3_ETM_ETMDEVTYPE_ADDR A:0xe0041fcc
y.create.l HWIO_RPM_M3_ETM_ETMPID4_ADDR A:0xe0041fd0
y.create.l HWIO_RPM_M3_ETM_ETMPID5_ADDR A:0xe0041fd4
y.create.l HWIO_RPM_M3_ETM_ETMPID6_ADDR A:0xe0041fd8
y.create.l HWIO_RPM_M3_ETM_ETMPID7_ADDR A:0xe0041fdc
y.create.l HWIO_RPM_M3_ETM_ETMPID0_ADDR A:0xe0041fe0
y.create.l HWIO_RPM_M3_ETM_ETMPID1_ADDR A:0xe0041fe4
y.create.l HWIO_RPM_M3_ETM_ETMPID2_ADDR A:0xe0041fe8
y.create.l HWIO_RPM_M3_ETM_ETMPID3_ADDR A:0xe0041fec
y.create.l HWIO_RPM_M3_ETM_ETMCID0_ADDR A:0xe0041ff0
y.create.l HWIO_RPM_M3_ETM_ETMCID1_ADDR A:0xe0041ff4
y.create.l HWIO_RPM_M3_ETM_ETMCID2_ADDR A:0xe0041ff8
y.create.l HWIO_RPM_M3_ETM_ETMCID3_ADDR A:0xe0041ffc
y.create.l HWIO_RPM_M3_ROM_TABLE_SCS_ADDR A:0xe00ff000
y.create.l HWIO_RPM_M3_ROM_TABLE_DWT_ADDR A:0xe00ff004
y.create.l HWIO_RPM_M3_ROM_TABLE_FPB_ADDR A:0xe00ff008
y.create.l HWIO_RPM_M3_ROM_TABLE_ITM_ADDR A:0xe00ff00c
y.create.l HWIO_RPM_M3_ROM_TABLE_TPIU_ADDR A:0xe00ff010
y.create.l HWIO_RPM_M3_ROM_TABLE_ETM_ADDR A:0xe00ff014
y.create.l HWIO_RPM_M3_ROM_TABLE_END_ADDR A:0xe00ff018
y.create.l HWIO_RPM_M3_ROM_TABLE_SYSTEM_ACCESS_ADDR A:0xe00fffcc
y.create.l HWIO_RPM_M3_ROM_TABLE_PID4_ADDR A:0xe00fffd0
y.create.l HWIO_RPM_M3_ROM_TABLE_PID5_ADDR A:0xe00fffd4
y.create.l HWIO_RPM_M3_ROM_TABLE_PID6_ADDR A:0xe00fffd8
y.create.l HWIO_RPM_M3_ROM_TABLE_PID7_ADDR A:0xe00fffdc
y.create.l HWIO_RPM_M3_ROM_TABLE_PID0_ADDR A:0xe00fffe0
y.create.l HWIO_RPM_M3_ROM_TABLE_PID1_ADDR A:0xe00fffe4
y.create.l HWIO_RPM_M3_ROM_TABLE_PID2_ADDR A:0xe00fffe8
y.create.l HWIO_RPM_M3_ROM_TABLE_PID3_ADDR A:0xe00fffec
y.create.l HWIO_RPM_M3_ROM_TABLE_CID0_ADDR A:0xe00ffff0
y.create.l HWIO_RPM_M3_ROM_TABLE_CID1_ADDR A:0xe00ffff4
y.create.l HWIO_RPM_M3_ROM_TABLE_CID2_ADDR A:0xe00ffff8
y.create.l HWIO_RPM_M3_ROM_TABLE_CID3_ADDR A:0xe00ffffc
y.create.l HWIO_SDC1_SDCC_MCI_POWER_ADDR A:0x67824000
y.create.l HWIO_SDC1_SDCC_MCI_CLK_ADDR A:0x67824004
y.create.l HWIO_SDC1_SDCC_MCI_ARGUMENT_ADDR A:0x67824008
y.create.l HWIO_SDC1_SDCC_MCI_CMD_ADDR A:0x6782400c
y.create.l HWIO_SDC1_SDCC_MCI_RESP_CMD_ADDR A:0x67824010
y.create.l HWIO_SDC1_SDCC_MCI_RESP0_ADDR A:0x67824014
y.create.l HWIO_SDC1_SDCC_MCI_RESP1_ADDR A:0x67824018
y.create.l HWIO_SDC1_SDCC_MCI_RESP2_ADDR A:0x6782401c
y.create.l HWIO_SDC1_SDCC_MCI_RESP3_ADDR A:0x67824020
y.create.l HWIO_SDC1_SDCC_MCI_DATA_TIMER_ADDR A:0x67824024
y.create.l HWIO_SDC1_SDCC_MCI_DATA_LENGTH_ADDR A:0x67824028
y.create.l HWIO_SDC1_SDCC_MCI_DATA_CTL_ADDR A:0x6782402c
y.create.l HWIO_SDC1_SDCC_MCI_DATA_COUNT_ADDR A:0x67824030
y.create.l HWIO_SDC1_SDCC_MCI_STATUS_ADDR A:0x67824034
y.create.l HWIO_SDC1_SDCC_MCI_CLEAR_ADDR A:0x67824038
y.create.l HWIO_SDC1_SDCC_MCI_INT_MASK0_ADDR A:0x6782403c
y.create.l HWIO_SDC1_SDCC_MCI_INT_MASK1_ADDR A:0x67824040
y.create.l HWIO_SDC1_SDCC_MCI_FIFO_COUNT_ADDR A:0x67824044
y.create.l HWIO_SDC1_SDCC_MCI_BOOT_ADDR A:0x67824048
y.create.l HWIO_SDC1_SDCC_MCI_BOOT_ACK_TIMER_ADDR A:0x6782404c
y.create.l HWIO_SDC1_SDCC_MCI_VERSION_ADDR A:0x67824050
y.create.l HWIO_SDC1_SDCC_MCI_EMULATION_DLY_LINE_ADDR A:0x67824054
y.create.l HWIO_SDC1_SDCC_MCI_CCS_TIMER_ADDR A:0x67824058
y.create.l HWIO_SDC1_SDCC_MCI_RESPONSE_MASK_ADDR A:0x6782405c
y.create.l HWIO_SDC1_SDCC_MCI_DLL_CONFIG_ADDR A:0x67824060
y.create.l HWIO_SDC1_SDCC_MCI_DLL_TEST_CTL_ADDR A:0x67824064
y.create.l HWIO_SDC1_SDCC_MCI_DLL_STATUS_ADDR A:0x67824068
y.create.l HWIO_SDC1_SDCC_MCI_STATUS2_ADDR A:0x6782406c
y.create.l HWIO_SDC1_SDCC_MCI_GENERICS_ADDR A:0x67824070
y.create.l HWIO_SDC1_SDCC_MCI_FIFO_STATUS_ADDR A:0x67824074
y.create.l HWIO_SDC1_SDCC_MCI_HC_MODE_ADDR A:0x67824078
y.create.l HWIO_SDC1_SDCC_MCI_FIFO0_ADDR A:0x67824080
y.create.l HWIO_SDC1_SDCC_MCI_FIFO1_ADDR A:0x67824084
y.create.l HWIO_SDC1_SDCC_MCI_FIFO2_ADDR A:0x67824088
y.create.l HWIO_SDC1_SDCC_MCI_FIFO3_ADDR A:0x6782408c
y.create.l HWIO_SDC1_SDCC_MCI_FIFO4_ADDR A:0x67824090
y.create.l HWIO_SDC1_SDCC_MCI_FIFO5_ADDR A:0x67824094
y.create.l HWIO_SDC1_SDCC_MCI_FIFO6_ADDR A:0x67824098
y.create.l HWIO_SDC1_SDCC_MCI_FIFO7_ADDR A:0x6782409c
y.create.l HWIO_SDC1_SDCC_MCI_FIFO8_ADDR A:0x678240a0
y.create.l HWIO_SDC1_SDCC_MCI_FIFO9_ADDR A:0x678240a4
y.create.l HWIO_SDC1_SDCC_MCI_TESTBUS_CONFIG_ADDR A:0x678240cc
y.create.l HWIO_SDC1_SDCC_MCI_TEST_CTL_ADDR A:0x678240d0
y.create.l HWIO_SDC1_SDCC_MCI_TEST_INPUT_ADDR A:0x678240d4
y.create.l HWIO_SDC1_SDCC_MCI_TEST_OUT_ADDR A:0x678240d8
y.create.l HWIO_SDC1_SDCC_MCI_PWRCTL_STATUS_REG_ADDR A:0x678240dc
y.create.l HWIO_SDC1_SDCC_MCI_PWRCTL_MASK_REG_ADDR A:0x678240e0
y.create.l HWIO_SDC1_SDCC_MCI_PWRCTL_CLEAR_REG_ADDR A:0x678240e4
y.create.l HWIO_SDC1_SDCC_MCI_PWRCTL_CTL_REG_ADDR A:0x678240e8
y.create.l HWIO_SDC1_SDCC_MCI_CLEAR2_ADDR A:0x678240ec
y.create.l HWIO_SDC1_SDCC_MCI_INT_MASKINT2_0_ADDR A:0x678240f0
y.create.l HWIO_SDC1_SDCC_MCI_INT_MASKINT2_1_ADDR A:0x678240f4
y.create.l HWIO_SDC1_SDCC_CHAR_CFG_ADDR A:0x678240fc
y.create.l HWIO_SDC1_SDCC_CHAR_CMD_ADDR A:0x67824100
y.create.l HWIO_SDC1_SDCC_CHAR_DATA_0_ADDR A:0x67824104
y.create.l HWIO_SDC1_SDCC_CHAR_DATA_1_ADDR A:0x67824108
y.create.l HWIO_SDC1_SDCC_CHAR_DATA_2_ADDR A:0x6782410c
y.create.l HWIO_SDC1_SDCC_CHAR_DATA_3_ADDR A:0x67824110
y.create.l HWIO_SDC1_SDCC_CHAR_DATA_4_ADDR A:0x67824114
y.create.l HWIO_SDC1_SDCC_CHAR_DATA_5_ADDR A:0x67824118
y.create.l HWIO_SDC1_SDCC_CHAR_DATA_6_ADDR A:0x6782411c
y.create.l HWIO_SDC1_SDCC_CHAR_DATA_7_ADDR A:0x67824120
y.create.l HWIO_SDC1_SDCC_DEBUG_REG_ADDR A:0x67824124
y.create.l HWIO_SDC1_SDCC_IP_CATALOG_ADDR A:0x67824128
y.create.l HWIO_SDC1_SDCC_QSB_VALUES_ADDR A:0x6782412c
y.create.l HWIO_SDC1_SDCC_QSB_AXI_VALUES_ADDR A:0x67824130
y.create.l HWIO_SDC1_SDCC_AXI_DATA_ERR_DBUG_ADDR A:0x67824134
y.create.l HWIO_SDC1_SDCC_T4_DLY_CTRL_ADDR A:0x67824138
y.create.l HWIO_SDC1_SDCC_T4_DLY_STAT_ADDR A:0x6782413c
y.create.l HWIO_SDC1_SDCC_CSR_CDC_CTLR_CFG0_ADDR A:0x67824140
y.create.l HWIO_SDC1_SDCC_CSR_CDC_CTLR_CFG1_ADDR A:0x67824144
y.create.l HWIO_SDC1_SDCC_CSR_CDC_CAL_TIMER_CFG0_ADDR A:0x67824148
y.create.l HWIO_SDC1_SDCC_CSR_CDC_CAL_TIMER_CFG1_ADDR A:0x6782414c
y.create.l HWIO_SDC1_SDCC_CSR_CDC_REFCOUNT_CFG_ADDR A:0x67824150
y.create.l HWIO_SDC1_SDCC_CSR_CDC_COARSE_CAL_CFG_ADDR A:0x67824154
y.create.l HWIO_SDC1_SDCC_CSR_CDC_RSVD_CFG_ADDR A:0x67824158
y.create.l HWIO_SDC1_SDCC_CSR_CDC_OFFSET_CFG_ADDR A:0x6782415c
y.create.l HWIO_SDC1_SDCC_CSR_CDC_DELAY_CFG_ADDR A:0x67824160
y.create.l HWIO_SDC1_SDCC_CSR_CDC_SW_MODE_CFG_ADDR A:0x67824164
y.create.l HWIO_SDC1_SDCC_CSR_CDC_TEST_CFG_ADDR A:0x67824168
y.create.l HWIO_SDC1_SDCC_CSR_CDC_SW_OVRD_CFG_ADDR A:0x6782416c
y.create.l HWIO_SDC1_SDCC_CSR_CDC_SLAVE_DDA_CFG_ADDR A:0x67824170
y.create.l HWIO_SDC1_SDCC_CSR_CDC_STATUS0_ADDR A:0x67824174
y.create.l HWIO_SDC1_SDCC_CSR_CDC_STATUS1_ADDR A:0x67824178
y.create.l HWIO_SDC1_SDCC_CSR_CDC_STATUS2_ADDR A:0x6782417c
y.create.l HWIO_SDC1_SDCC_CSR_CDC_STATUS3_ADDR A:0x67824180
y.create.l HWIO_SDC1_SDCC_CSR_CDC_STATUS4_ADDR A:0x67824184
y.create.l HWIO_SDC1_SDCC_CSR_CDC_GEN_CFG_ADDR A:0x67824188
y.create.l HWIO_SDC1_SDCC_CDC_AUTO_SW_CAL_CFG_ADDR A:0x6782418c
y.create.l HWIO_SDC1_SDCC_DDR200_STAT_ADDR A:0x67824190
y.create.l HWIO_SDC1_SDCC_DDR200_CFG_ADDR A:0x67824194
y.create.l HWIO_SDC1_SDCC_TIME_COUNT_CTRL_ADDR A:0x67824198
y.create.l HWIO_SDC1_SDCC_FLOW_CTRL_TIME_COUNT_ADDR A:0x6782419c
y.create.l HWIO_SDC1_SDCC_BUSY_TIME_COUNT_ADDR A:0x678241a0
y.create.l HWIO_SDC1_SDCC_DATA_TIME_COUNT_ADDR A:0x678241a4
y.create.l HWIO_SDC1_SDCC_CMD_TIME_COUNT_ADDR A:0x678241a8
y.create.l HWIO_SDC1_SDCC_MCI_DLL_CONFIG_2_ADDR A:0x678241ac
y.create.l HWIO_SDC1_SDCC_MCI_DDR_CONFIG_ADDR A:0x678241b0
y.create.l HWIO_SDC1_SDCC_DML_SW_RESET_ADDR A:0x678241b4
y.create.l HWIO_SDC1_SDCC_MCI_FIFO_ALT0_ADDR A:0x67824400
y.create.l HWIO_SDC1_SDCC_MCI_FIFO_ALT1_ADDR A:0x67824404
y.create.l HWIO_SDC1_SDCC_MCI_FIFO_ALT2_ADDR A:0x67824408
y.create.l HWIO_SDC1_SDCC_MCI_FIFO_ALT3_ADDR A:0x6782440c
y.create.l HWIO_SDC1_SDCC_MCI_FIFO_ALT4_ADDR A:0x67824410
y.create.l HWIO_SDC1_SDCC_MCI_FIFO_ALT5_ADDR A:0x67824414
y.create.l HWIO_SDC1_SDCC_MCI_FIFO_ALT6_ADDR A:0x67824418
y.create.l HWIO_SDC1_SDCC_MCI_FIFO_ALT7_ADDR A:0x6782441c
y.create.l HWIO_SDC1_SDCC_MCI_FIFO_ALT8_ADDR A:0x67824420
y.create.l HWIO_SDC1_SDCC_MCI_FIFO_ALT9_ADDR A:0x67824424
y.create.l HWIO_SDC1_SDCC_HC_REG_0_2_ADDR A:0x67824900
y.create.l HWIO_SDC1_SDCC_HC_REG_4_6_ADDR A:0x67824904
y.create.l HWIO_SDC1_SDCC_HC_REG_8_A_ADDR A:0x67824908
y.create.l HWIO_SDC1_SDCC_HC_REG_C_E_ADDR A:0x6782490c
y.create.l HWIO_SDC1_SDCC_HC_REG_10_12_ADDR A:0x67824910
y.create.l HWIO_SDC1_SDCC_HC_REG_14_16_ADDR A:0x67824914
y.create.l HWIO_SDC1_SDCC_HC_REG_18_1A_ADDR A:0x67824918
y.create.l HWIO_SDC1_SDCC_HC_REG_1C_1E_ADDR A:0x6782491c
y.create.l HWIO_SDC1_SDCC_HC_REG_20_22_ADDR A:0x67824920
y.create.l HWIO_SDC1_SDCC_HC_REG_24_26_ADDR A:0x67824924
y.create.l HWIO_SDC1_SDCC_HC_REG_28_2A_ADDR A:0x67824928
y.create.l HWIO_SDC1_SDCC_HC_REG_2C_2E_ADDR A:0x6782492c
y.create.l HWIO_SDC1_SDCC_HC_REG_30_32_ADDR A:0x67824930
y.create.l HWIO_SDC1_SDCC_HC_REG_34_36_ADDR A:0x67824934
y.create.l HWIO_SDC1_SDCC_HC_REG_38_3A_ADDR A:0x67824938
y.create.l HWIO_SDC1_SDCC_HC_REG_3C_3E_ADDR A:0x6782493c
y.create.l HWIO_SDC1_SDCC_HC_REG_40_42_ADDR A:0x67824940
y.create.l HWIO_SDC1_SDCC_HC_REG_44_46_ADDR A:0x67824944
y.create.l HWIO_SDC1_SDCC_HC_REG_48_4A_ADDR A:0x67824948
y.create.l HWIO_SDC1_SDCC_HC_REG_50_52_ADDR A:0x67824950
y.create.l HWIO_SDC1_SDCC_HC_REG_54_56_ADDR A:0x67824954
y.create.l HWIO_SDC1_SDCC_HC_REG_58_5A_ADDR A:0x67824958
y.create.l HWIO_SDC1_SDCC_HC_REG_5C_5E_ADDR A:0x6782495c
y.create.l HWIO_SDC1_SDCC_HC_REG_60_62_ADDR A:0x67824960
y.create.l HWIO_SDC1_SDCC_HC_REG_64_66_ADDR A:0x67824964
y.create.l HWIO_SDC1_SDCC_HC_REG_68_6A_ADDR A:0x67824968
y.create.l HWIO_SDC1_SDCC_HC_REG_6C_6E_ADDR A:0x6782496c
y.create.l HWIO_SDC1_SDCC_HC_REG_E0_E2_ADDR A:0x678249e0
y.create.l HWIO_SDC1_SDCC_HC_REG_FC_FE_ADDR A:0x678249fc
y.create.l HWIO_SDC1_SDCC_HC_REG_DLL_CONFIG_ADDR A:0x67824a00
y.create.l HWIO_SDC1_SDCC_HC_REG_DLL_TEST_CTL_ADDR A:0x67824a04
y.create.l HWIO_SDC1_SDCC_HC_REG_DLL_STATUS_ADDR A:0x67824a08
y.create.l HWIO_SDC1_SDCC_HC_VENDOR_SPECIFIC_FUNC_ADDR A:0x67824a0c
y.create.l HWIO_SDC1_SDCC_HC_VENDOR_SPECIFIC_FUNC2_ADDR A:0x67824a10
y.create.l HWIO_SDC1_SDCC_HC_VENDOR_SPECIFIC_ADMA_ERR_ADDR0_ADDR A:0x67824a14
y.create.l HWIO_SDC1_SDCC_HC_VENDOR_SPECIFIC_ADMA_ERR_ADDR1_ADDR A:0x67824a18
y.create.l HWIO_SDC1_SDCC_HC_VENDOR_SPECIFIC_CAPABILITIES0_ADDR A:0x67824a1c
y.create.l HWIO_SDC1_SDCC_HC_VENDOR_SPECIFIC_CAPABILITIES1_ADDR A:0x67824a20
y.create.l HWIO_SDC1_SDCC_HC_VENDOR_SPECIFIC_T4_DLY_CTRL_ADDR A:0x67824a24
y.create.l HWIO_SDC1_SDCC_HC_VENDOR_SPECIFIC_T4_DLY_STAT_ADDR A:0x67824a28
y.create.l HWIO_SDC1_SDCC_HC_VENDOR_SPECIFIC_CSR_CDC_CTLR_CFG0_ADDR A:0x67824a30
y.create.l HWIO_SDC1_SDCC_HC_VENDOR_SPECIFIC_CSR_CDC_CTLR_CFG1_ADDR A:0x67824a34
y.create.l HWIO_SDC1_SDCC_HC_VENDOR_SPECIFIC_CSR_CDC_CAL_TIMER_CFG0_ADDR A:0x67824a38
y.create.l HWIO_SDC1_SDCC_HC_VENDOR_SPECIFIC_CSR_CDC_CAL_TIMER_CFG1_ADDR A:0x67824a3c
y.create.l HWIO_SDC1_SDCC_HC_VENDOR_SPECIFIC_CSR_CDC_REFCOUNT_CFG_ADDR A:0x67824a40
y.create.l HWIO_SDC1_SDCC_HC_VENDOR_SPECIFIC_CSR_CDC_COARSE_CAL_CFG_ADDR A:0x67824a44
y.create.l HWIO_SDC1_SDCC_HC_VENDOR_SPECIFIC_CSR_CDC_RSVD_CFG_ADDR A:0x67824a48
y.create.l HWIO_SDC1_SDCC_HC_VENDOR_SPECIFIC_CSR_CDC_OFFSET_CFG_ADDR A:0x67824a4c
y.create.l HWIO_SDC1_SDCC_HC_VENDOR_SPECIFIC_CSR_CDC_DELAY_CFG_ADDR A:0x67824a50
y.create.l HWIO_SDC1_SDCC_HC_VENDOR_SPECIFIC_CSR_CDC_SW_MODE_CFG_ADDR A:0x67824a54
y.create.l HWIO_SDC1_SDCC_HC_VENDOR_SPECIFIC_CSR_CDC_TEST_CFG_ADDR A:0x67824a58
y.create.l HWIO_SDC1_SDCC_HC_VENDOR_SPECIFIC_CSR_CDC_SW_OVRD_CFG_ADDR A:0x67824a5c
y.create.l HWIO_SDC1_SDCC_HC_VENDOR_SPECIFIC_CSR_CDC_SLAVE_DDA_CFG_ADDR A:0x67824a60
y.create.l HWIO_SDC1_SDCC_HC_VENDOR_SPECIFIC_CSR_CDC_STATUS0_ADDR A:0x67824a64
y.create.l HWIO_SDC1_SDCC_HC_VENDOR_SPECIFIC_CSR_CDC_STATUS1_ADDR A:0x67824a68
y.create.l HWIO_SDC1_SDCC_HC_VENDOR_SPECIFIC_CSR_CDC_STATUS2_ADDR A:0x67824a6c
y.create.l HWIO_SDC1_SDCC_HC_VENDOR_SPECIFIC_CSR_CDC_STATUS3_ADDR A:0x67824a70
y.create.l HWIO_SDC1_SDCC_HC_VENDOR_SPECIFIC_CSR_CDC_STATUS4_ADDR A:0x67824a74
y.create.l HWIO_SDC1_SDCC_HC_VENDOR_SPECIFIC_CSR_CDC_GEN_CFG_ADDR A:0x67824a78
y.create.l HWIO_SDC1_SDCC_HC_VENDOR_SPECIFIC_CDC_AUTO_SW_CAL_CFG_ADDR A:0x67824a7c
y.create.l HWIO_SDC1_SDCC_HC_VENDOR_SPECIFIC_DDR200_STAT_ADDR A:0x67824a80
y.create.l HWIO_SDC1_SDCC_HC_VENDOR_SPECIFIC_DDR200_CFG_ADDR A:0x67824a84
y.create.l HWIO_SDC1_SDCC_HC_VENDOR_SPECIFIC_TIME_COUNT_CTRL_ADDR A:0x67824a88
y.create.l HWIO_SDC1_SDCC_HC_VENDOR_SPECIFIC_FLOW_CTRL_TIME_COUNT_ADDR A:0x67824a8c
y.create.l HWIO_SDC1_SDCC_HC_VENDOR_SPECIFIC_BUSY_TIME_COUNT_ADDR A:0x67824a90
y.create.l HWIO_SDC1_SDCC_HC_VENDOR_SPECIFIC_DATA_TIME_COUNT_ADDR A:0x67824a94
y.create.l HWIO_SDC1_SDCC_HC_VENDOR_SPECIFIC_CMD_TIME_COUNT_ADDR A:0x67824a98
y.create.l HWIO_SDC1_SDCC_HC_VENDOR_SPECIFIC_ERR_INT_STS_ADDR A:0x67824a9c
y.create.l HWIO_SDC1_SDCC_HC_VENDOR_SPECIFIC_PWRCTL_STATUS_REG_ADDR A:0x67824aa0
y.create.l HWIO_SDC1_SDCC_HC_VENDOR_SPECIFIC_PWRCTL_MASK_REG_ADDR A:0x67824aa4
y.create.l HWIO_SDC1_SDCC_HC_VENDOR_SPECIFIC_PWRCTL_CLEAR_REG_ADDR A:0x67824aa8
y.create.l HWIO_SDC1_SDCC_HC_VENDOR_SPECIFIC_PWRCTL_CTL_REG_ADDR A:0x67824aac
y.create.l HWIO_SDC1_SDCC_HC_VENDOR_SPECIFIC_FUNC3_ADDR A:0x67824ab0
y.create.l HWIO_SDC1_SDCC_HC_REG_DLL_CONFIG_2_ADDR A:0x67824ab4
y.create.l HWIO_SDC1_SDCC_HC_REG_DDR_CONFIG_ADDR A:0x67824ab8
y.create.l HWIO_SDC1_SDCC_HC_VENDOR_SPECIFIC_FUNC4_ADDR A:0x67824abc
y.create.l HWIO_SDC1_SDCC_HC_VENDOR_SPECIFIC_SCM_CFG_ADDR A:0x67825000
y.create.l HWIO_SDC1_SDCC_HC_VENDOR_SPECIFIC_SCM_AXI_VALUES_ADDR A:0x67825004
y.create.l HWIO_SDC1_SDCC_HC_VENDOR_SPECIFIC_SCM_MASK_ADDR A:0x67825008
y.create.l HWIO_SDC1_SDCC_HC_VENDOR_SPECIFIC_SCM_STATUS_ADDR A:0x6782500c
y.create.l HWIO_SDC1_SDCC_HC_VENDOR_SPECIFIC_SCM_SECURITY_ADDR A:0x67825010
y.create.l HWIO_QFPROM_RAW_JTAG_ID_ADDR A:0x60058000
y.create.l HWIO_QFPROM_RAW_PTE1_ADDR A:0x60058004
y.create.l HWIO_QFPROM_RAW_SERIAL_NUM_ADDR A:0x60058008
y.create.l HWIO_QFPROM_RAW_PTE2_ADDR A:0x6005800c
y.create.l HWIO_QFPROM_RAW_RD_WR_PERM_LSB_ADDR A:0x60058010
y.create.l HWIO_QFPROM_RAW_RD_WR_PERM_MSB_ADDR A:0x60058014
y.create.l HWIO_QFPROM_RAW_ANTI_ROLLBACK_1_LSB_ADDR A:0x60058018
y.create.l HWIO_QFPROM_RAW_ANTI_ROLLBACK_1_MSB_ADDR A:0x6005801c
y.create.l HWIO_QFPROM_RAW_ANTI_ROLLBACK_2_LSB_ADDR A:0x60058020
y.create.l HWIO_QFPROM_RAW_ANTI_ROLLBACK_2_MSB_ADDR A:0x60058024
y.create.l HWIO_QFPROM_RAW_ANTI_ROLLBACK_3_LSB_ADDR A:0x60058028
y.create.l HWIO_QFPROM_RAW_ANTI_ROLLBACK_3_MSB_ADDR A:0x6005802c
y.create.l HWIO_QFPROM_RAW_OEM_CONFIG_ROW0_LSB_ADDR A:0x60058030
y.create.l HWIO_QFPROM_RAW_OEM_CONFIG_ROW0_MSB_ADDR A:0x60058034
y.create.l HWIO_QFPROM_RAW_OEM_CONFIG_ROW1_LSB_ADDR A:0x60058038
y.create.l HWIO_QFPROM_RAW_OEM_CONFIG_ROW1_MSB_ADDR A:0x6005803c
y.create.l HWIO_QFPROM_RAW_FEAT_CONFIG_ROW0_LSB_ADDR A:0x60058040
y.create.l HWIO_QFPROM_RAW_FEAT_CONFIG_ROW0_MSB_ADDR A:0x60058044
y.create.l HWIO_QFPROM_RAW_FEAT_CONFIG_ROW1_LSB_ADDR A:0x60058048
y.create.l HWIO_QFPROM_RAW_FEAT_CONFIG_ROW1_MSB_ADDR A:0x6005804c
y.create.l HWIO_QFPROM_RAW_FEAT_CONFIG_ROW2_LSB_ADDR A:0x60058050
y.create.l HWIO_QFPROM_RAW_FEAT_CONFIG_ROW2_MSB_ADDR A:0x60058054
y.create.l HWIO_QFPROM_RAW_PRI_KEY_DERIVATION_KEY_ROW0_LSB_ADDR A:0x60058058
y.create.l HWIO_QFPROM_RAW_PRI_KEY_DERIVATION_KEY_ROW1_LSB_ADDR A:0x60058060
y.create.l HWIO_QFPROM_RAW_PRI_KEY_DERIVATION_KEY_ROW2_LSB_ADDR A:0x60058068
y.create.l HWIO_QFPROM_RAW_PRI_KEY_DERIVATION_KEY_ROW3_LSB_ADDR A:0x60058070
y.create.l HWIO_QFPROM_RAW_PRI_KEY_DERIVATION_KEY_ROW0_MSB_ADDR A:0x6005805c
y.create.l HWIO_QFPROM_RAW_PRI_KEY_DERIVATION_KEY_ROW1_MSB_ADDR A:0x60058064
y.create.l HWIO_QFPROM_RAW_PRI_KEY_DERIVATION_KEY_ROW2_MSB_ADDR A:0x6005806c
y.create.l HWIO_QFPROM_RAW_PRI_KEY_DERIVATION_KEY_ROW3_MSB_ADDR A:0x60058074
y.create.l HWIO_QFPROM_RAW_SEC_KEY_DERIVATION_KEY_ROW0_LSB_ADDR A:0x60058078
y.create.l HWIO_QFPROM_RAW_SEC_KEY_DERIVATION_KEY_ROW1_LSB_ADDR A:0x60058080
y.create.l HWIO_QFPROM_RAW_SEC_KEY_DERIVATION_KEY_ROW2_LSB_ADDR A:0x60058088
y.create.l HWIO_QFPROM_RAW_SEC_KEY_DERIVATION_KEY_ROW3_LSB_ADDR A:0x60058090
y.create.l HWIO_QFPROM_RAW_SEC_KEY_DERIVATION_KEY_ROW0_MSB_ADDR A:0x6005807c
y.create.l HWIO_QFPROM_RAW_SEC_KEY_DERIVATION_KEY_ROW1_MSB_ADDR A:0x60058084
y.create.l HWIO_QFPROM_RAW_SEC_KEY_DERIVATION_KEY_ROW2_MSB_ADDR A:0x6005808c
y.create.l HWIO_QFPROM_RAW_SEC_KEY_DERIVATION_KEY_ROW3_MSB_ADDR A:0x60058094
y.create.l HWIO_QFPROM_RAW_OEM_SEC_BOOT_ROW0_LSB_ADDR A:0x60058098
y.create.l HWIO_QFPROM_RAW_OEM_SEC_BOOT_ROW0_MSB_ADDR A:0x6005809c
y.create.l HWIO_QFPROM_RAW_QC_SEC_BOOT_ROW0_LSB_ADDR A:0x600580a0
y.create.l HWIO_QFPROM_RAW_QC_SEC_BOOT_ROW0_MSB_ADDR A:0x600580a4
y.create.l HWIO_QFPROM_RAW_PK_HASH_ROW0_LSB_ADDR A:0x600580a8
y.create.l HWIO_QFPROM_RAW_PK_HASH_ROW1_LSB_ADDR A:0x600580b0
y.create.l HWIO_QFPROM_RAW_PK_HASH_ROW2_LSB_ADDR A:0x600580b8
y.create.l HWIO_QFPROM_RAW_PK_HASH_ROW3_LSB_ADDR A:0x600580c0
y.create.l HWIO_QFPROM_RAW_PK_HASH_ROW0_MSB_ADDR A:0x600580ac
y.create.l HWIO_QFPROM_RAW_PK_HASH_ROW1_MSB_ADDR A:0x600580b4
y.create.l HWIO_QFPROM_RAW_PK_HASH_ROW2_MSB_ADDR A:0x600580bc
y.create.l HWIO_QFPROM_RAW_PK_HASH_ROW3_MSB_ADDR A:0x600580c4
y.create.l HWIO_QFPROM_RAW_PK_HASH_ROW4_LSB_ADDR A:0x600580c8
y.create.l HWIO_QFPROM_RAW_PK_HASH_ROW4_MSB_ADDR A:0x600580cc
y.create.l HWIO_QFPROM_RAW_CALIB_ROW0_LSB_ADDR A:0x600580d0
y.create.l HWIO_QFPROM_RAW_CALIB_ROW0_MSB_ADDR A:0x600580d4
y.create.l HWIO_QFPROM_RAW_CALIB_ROW1_LSB_ADDR A:0x600580d8
y.create.l HWIO_QFPROM_RAW_CALIB_ROW1_MSB_ADDR A:0x600580dc
y.create.l HWIO_QFPROM_RAW_CALIB_ROW2_LSB_ADDR A:0x600580e0
y.create.l HWIO_QFPROM_RAW_CALIB_ROW2_MSB_ADDR A:0x600580e4
y.create.l HWIO_QFPROM_RAW_CALIB_ROW3_LSB_ADDR A:0x600580e8
y.create.l HWIO_QFPROM_RAW_CALIB_ROW3_MSB_ADDR A:0x600580ec
y.create.l HWIO_QFPROM_RAW_CALIB_ROW4_LSB_ADDR A:0x600580f0
y.create.l HWIO_QFPROM_RAW_CALIB_ROW4_MSB_ADDR A:0x600580f4
y.create.l HWIO_QFPROM_RAW_CALIB_ROW5_LSB_ADDR A:0x600580f8
y.create.l HWIO_QFPROM_RAW_CALIB_ROW5_MSB_ADDR A:0x600580fc
y.create.l HWIO_QFPROM_RAW_CALIB_ROW6_LSB_ADDR A:0x60058100
y.create.l HWIO_QFPROM_RAW_CALIB_ROW6_MSB_ADDR A:0x60058104
y.create.l HWIO_QFPROM_RAW_MEM_CONFIG_ROW0_LSB_ADDR A:0x60058108
y.create.l HWIO_QFPROM_RAW_MEM_CONFIG_ROW1_LSB_ADDR A:0x60058110
y.create.l HWIO_QFPROM_RAW_MEM_CONFIG_ROW2_LSB_ADDR A:0x60058118
y.create.l HWIO_QFPROM_RAW_MEM_CONFIG_ROW3_LSB_ADDR A:0x60058120
y.create.l HWIO_QFPROM_RAW_MEM_CONFIG_ROW4_LSB_ADDR A:0x60058128
y.create.l HWIO_QFPROM_RAW_MEM_CONFIG_ROW5_LSB_ADDR A:0x60058130
y.create.l HWIO_QFPROM_RAW_MEM_CONFIG_ROW6_LSB_ADDR A:0x60058138
y.create.l HWIO_QFPROM_RAW_MEM_CONFIG_ROW7_LSB_ADDR A:0x60058140
y.create.l HWIO_QFPROM_RAW_MEM_CONFIG_ROW8_LSB_ADDR A:0x60058148
y.create.l HWIO_QFPROM_RAW_MEM_CONFIG_ROW9_LSB_ADDR A:0x60058150
y.create.l HWIO_QFPROM_RAW_MEM_CONFIG_ROW0_MSB_ADDR A:0x6005810c
y.create.l HWIO_QFPROM_RAW_MEM_CONFIG_ROW1_MSB_ADDR A:0x60058114
y.create.l HWIO_QFPROM_RAW_MEM_CONFIG_ROW2_MSB_ADDR A:0x6005811c
y.create.l HWIO_QFPROM_RAW_MEM_CONFIG_ROW3_MSB_ADDR A:0x60058124
y.create.l HWIO_QFPROM_RAW_MEM_CONFIG_ROW4_MSB_ADDR A:0x6005812c
y.create.l HWIO_QFPROM_RAW_MEM_CONFIG_ROW5_MSB_ADDR A:0x60058134
y.create.l HWIO_QFPROM_RAW_MEM_CONFIG_ROW6_MSB_ADDR A:0x6005813c
y.create.l HWIO_QFPROM_RAW_MEM_CONFIG_ROW7_MSB_ADDR A:0x60058144
y.create.l HWIO_QFPROM_RAW_MEM_CONFIG_ROW8_MSB_ADDR A:0x6005814c
y.create.l HWIO_QFPROM_RAW_MEM_CONFIG_ROW9_MSB_ADDR A:0x60058154
y.create.l HWIO_QFPROM_RAW_MEM_CONFIG_ROW16_LSB_ADDR A:0x60058188
y.create.l HWIO_QFPROM_RAW_MEM_CONFIG_ROW16_MSB_ADDR A:0x6005818c
y.create.l HWIO_QFPROM_RAW_MEM_CONFIG_ROW17_LSB_ADDR A:0x60058190
y.create.l HWIO_QFPROM_RAW_MEM_CONFIG_ROW17_MSB_ADDR A:0x60058194
y.create.l HWIO_QFPROM_RAW_MEM_CONFIG_ROW18_LSB_ADDR A:0x60058198
y.create.l HWIO_QFPROM_RAW_MEM_CONFIG_ROW18_MSB_ADDR A:0x6005819c
y.create.l HWIO_QFPROM_RAW_MEM_CONFIG_ROW19_LSB_ADDR A:0x600581a0
y.create.l HWIO_QFPROM_RAW_MEM_CONFIG_ROW19_MSB_ADDR A:0x600581a4
y.create.l HWIO_QFPROM_RAW_MEM_CONFIG_ROW20_LSB_ADDR A:0x600581a8
y.create.l HWIO_QFPROM_RAW_MEM_CONFIG_ROW20_MSB_ADDR A:0x600581ac
y.create.l HWIO_QFPROM_RAW_ROM_PATCH_ROW0_LSB_ADDR A:0x600581b0
y.create.l HWIO_QFPROM_RAW_ROM_PATCH_ROW1_LSB_ADDR A:0x600581b8
y.create.l HWIO_QFPROM_RAW_ROM_PATCH_ROW2_LSB_ADDR A:0x600581c0
y.create.l HWIO_QFPROM_RAW_ROM_PATCH_ROW3_LSB_ADDR A:0x600581c8
y.create.l HWIO_QFPROM_RAW_ROM_PATCH_ROW4_LSB_ADDR A:0x600581d0
y.create.l HWIO_QFPROM_RAW_ROM_PATCH_ROW5_LSB_ADDR A:0x600581d8
y.create.l HWIO_QFPROM_RAW_ROM_PATCH_ROW6_LSB_ADDR A:0x600581e0
y.create.l HWIO_QFPROM_RAW_ROM_PATCH_ROW7_LSB_ADDR A:0x600581e8
y.create.l HWIO_QFPROM_RAW_ROM_PATCH_ROW8_LSB_ADDR A:0x600581f0
y.create.l HWIO_QFPROM_RAW_ROM_PATCH_ROW9_LSB_ADDR A:0x600581f8
y.create.l HWIO_QFPROM_RAW_ROM_PATCH_ROW0_MSB_ADDR A:0x600581b4
y.create.l HWIO_QFPROM_RAW_ROM_PATCH_ROW1_MSB_ADDR A:0x600581bc
y.create.l HWIO_QFPROM_RAW_ROM_PATCH_ROW2_MSB_ADDR A:0x600581c4
y.create.l HWIO_QFPROM_RAW_ROM_PATCH_ROW3_MSB_ADDR A:0x600581cc
y.create.l HWIO_QFPROM_RAW_ROM_PATCH_ROW4_MSB_ADDR A:0x600581d4
y.create.l HWIO_QFPROM_RAW_ROM_PATCH_ROW5_MSB_ADDR A:0x600581dc
y.create.l HWIO_QFPROM_RAW_ROM_PATCH_ROW6_MSB_ADDR A:0x600581e4
y.create.l HWIO_QFPROM_RAW_ROM_PATCH_ROW7_MSB_ADDR A:0x600581ec
y.create.l HWIO_QFPROM_RAW_ROM_PATCH_ROW8_MSB_ADDR A:0x600581f4
y.create.l HWIO_QFPROM_RAW_ROM_PATCH_ROW9_MSB_ADDR A:0x600581fc
y.create.l HWIO_QFPROM_RAW_FEC_EN_LSB_ADDR A:0x600582b0
y.create.l HWIO_QFPROM_RAW_FEC_EN_MSB_ADDR A:0x600582b4
y.create.l HWIO_QFPROM_RAW_SPARE_REG16_LSB_ADDR A:0x600582b8
y.create.l HWIO_QFPROM_RAW_SPARE_REG16_MSB_ADDR A:0x600582bc
y.create.l HWIO_QFPROM_RAW_SPARE_REG17_LSB_ADDR A:0x600582c0
y.create.l HWIO_QFPROM_RAW_SPARE_REG17_MSB_ADDR A:0x600582c4
y.create.l HWIO_QFPROM_RAW_SPARE_REG18_LSB_ADDR A:0x600582c8
y.create.l HWIO_QFPROM_RAW_SPARE_REG18_MSB_ADDR A:0x600582cc
y.create.l HWIO_QFPROM_RAW_SPARE_REG19_LSB_ADDR A:0x600582d0
y.create.l HWIO_QFPROM_RAW_SPARE_REG19_MSB_ADDR A:0x600582d4
y.create.l HWIO_QFPROM_RAW_SPARE_REG20_LSB_ADDR A:0x600582d8
y.create.l HWIO_QFPROM_RAW_SPARE_REG20_MSB_ADDR A:0x600582dc
y.create.l HWIO_QFPROM_RAW_SPARE_REG21_LSB_ADDR A:0x600582e0
y.create.l HWIO_QFPROM_RAW_SPARE_REG21_MSB_ADDR A:0x600582e4
y.create.l HWIO_QFPROM_RAW_ACC_PRIVATE0_ADDR A:0x60058400
y.create.l HWIO_QFPROM_RAW_ACC_PRIVATE1_ADDR A:0x60058404
y.create.l HWIO_QFPROM_RAW_ACC_PRIVATE2_ADDR A:0x60058408
y.create.l HWIO_QFPROM_RAW_ACC_PRIVATE3_ADDR A:0x6005840c
y.create.l HWIO_QFPROM_RAW_ACC_PRIVATE4_ADDR A:0x60058410
y.create.l HWIO_QFPROM_RAW_ACC_PRIVATE5_ADDR A:0x60058414
y.create.l HWIO_QFPROM_RAW_ACC_PRIVATE6_ADDR A:0x60058418
y.create.l HWIO_QFPROM_RAW_ACC_PRIVATE7_ADDR A:0x6005841c
y.create.l HWIO_QFPROM_RAW_ACC_PRIVATE8_ADDR A:0x60058420
y.create.l HWIO_QFPROM_RAW_ACC_PRIVATE9_ADDR A:0x60058424
y.create.l HWIO_ACC_IR_ADDR A:0x6005a000
y.create.l HWIO_ACC_DR_ADDR A:0x6005a004
y.create.l HWIO_ACC_VERID_ADDR A:0x6005a008
y.create.l HWIO_ACC_FEATSET0_ADDR A:0x6005a010
y.create.l HWIO_ACC_FEATSET1_ADDR A:0x6005a014
y.create.l HWIO_ACC_FEATSET2_ADDR A:0x6005a018
y.create.l HWIO_ACC_FEATSET3_ADDR A:0x6005a01c
y.create.l HWIO_ACC_FEATSET4_ADDR A:0x6005a020
y.create.l HWIO_ACC_FEATSET5_ADDR A:0x6005a024
y.create.l HWIO_ACC_FEATSET6_ADDR A:0x6005a028
y.create.l HWIO_ACC_FEATSET7_ADDR A:0x6005a02c
y.create.l HWIO_ACC_STATE_ADDR A:0x6005a038
y.create.l HWIO_QFPROM_BLOW_TIMER_ADDR A:0x6005a03c
y.create.l HWIO_QFPROM_TEST_CTRL_ADDR A:0x6005a040
y.create.l HWIO_QFPROM_ACCEL_ADDR A:0x6005a044
y.create.l HWIO_QFPROM_BLOW_STATUS_ADDR A:0x6005a048
y.create.l HWIO_QFPROM_ROM_ERROR_ADDR A:0x6005a04c
y.create.l HWIO_QFPROM_BIST_CTRL_ADDR A:0x6005a050
y.create.l HWIO_QFPROM_BIST_ERROR_ADDR A:0x6005a054
y.create.l HWIO_QFPROM_HASH_SIGNATURE0_ADDR A:0x6005a060
y.create.l HWIO_QFPROM_HASH_SIGNATURE1_ADDR A:0x6005a064
y.create.l HWIO_QFPROM_HASH_SIGNATURE2_ADDR A:0x6005a068
y.create.l HWIO_QFPROM_HASH_SIGNATURE3_ADDR A:0x6005a06c
y.create.l HWIO_QFPROM_HASH_SIGNATURE4_ADDR A:0x6005a070
y.create.l HWIO_QFPROM_HASH_SIGNATURE5_ADDR A:0x6005a074
y.create.l HWIO_QFPROM_HASH_SIGNATURE6_ADDR A:0x6005a078
y.create.l HWIO_QFPROM_HASH_SIGNATURE7_ADDR A:0x6005a07c
y.create.l HWIO_HW_KEY_STATUS_ADDR A:0x6005a080
y.create.l HWIO_RESET_JDR_STATUS_ADDR A:0x6005a084
y.create.l HWIO_FEC_ESR_ADDR A:0x6005a090
y.create.l HWIO_FEC_EAR_ADDR A:0x6005a094
y.create.l HWIO_QFPROM0_MATCH_STATUS_ADDR A:0x6005a098
y.create.l HWIO_QFPROM1_MATCH_STATUS_ADDR A:0x6005a09c
y.create.l HWIO_QFPROM_CORR_JTAG_ID_ADDR A:0x6005c000
y.create.l HWIO_QFPROM_CORR_PTE1_ADDR A:0x6005c004
y.create.l HWIO_QFPROM_CORR_SERIAL_NUM_ADDR A:0x6005c008
y.create.l HWIO_QFPROM_CORR_PTE2_ADDR A:0x6005c00c
y.create.l HWIO_QFPROM_CORR_RD_WR_PERM_LSB_ADDR A:0x6005c010
y.create.l HWIO_QFPROM_CORR_RD_WR_PERM_MSB_ADDR A:0x6005c014
y.create.l HWIO_QFPROM_CORR_ANTI_ROLLBACK_1_LSB_ADDR A:0x6005c018
y.create.l HWIO_QFPROM_CORR_ANTI_ROLLBACK_1_MSB_ADDR A:0x6005c01c
y.create.l HWIO_QFPROM_CORR_ANTI_ROLLBACK_2_LSB_ADDR A:0x6005c020
y.create.l HWIO_QFPROM_CORR_ANTI_ROLLBACK_2_MSB_ADDR A:0x6005c024
y.create.l HWIO_QFPROM_CORR_ANTI_ROLLBACK_3_LSB_ADDR A:0x6005c028
y.create.l HWIO_QFPROM_CORR_ANTI_ROLLBACK_3_MSB_ADDR A:0x6005c02c
y.create.l HWIO_QFPROM_CORR_OEM_CONFIG_ROW0_LSB_ADDR A:0x6005c030
y.create.l HWIO_QFPROM_CORR_OEM_CONFIG_ROW0_MSB_ADDR A:0x6005c034
y.create.l HWIO_QFPROM_CORR_OEM_CONFIG_ROW1_LSB_ADDR A:0x6005c038
y.create.l HWIO_QFPROM_CORR_OEM_CONFIG_ROW1_MSB_ADDR A:0x6005c03c
y.create.l HWIO_QFPROM_CORR_FEAT_CONFIG_ROW0_LSB_ADDR A:0x6005c040
y.create.l HWIO_QFPROM_CORR_FEAT_CONFIG_ROW0_MSB_ADDR A:0x6005c044
y.create.l HWIO_QFPROM_CORR_FEAT_CONFIG_ROW1_LSB_ADDR A:0x6005c048
y.create.l HWIO_QFPROM_CORR_FEAT_CONFIG_ROW1_MSB_ADDR A:0x6005c04c
y.create.l HWIO_QFPROM_CORR_FEAT_CONFIG_ROW2_LSB_ADDR A:0x6005c050
y.create.l HWIO_QFPROM_CORR_FEAT_CONFIG_ROW2_MSB_ADDR A:0x6005c054
y.create.l HWIO_QFPROM_CORR_PRI_KEY_DERIVATION_KEY_ROW0_LSB_ADDR A:0x6005c058
y.create.l HWIO_QFPROM_CORR_PRI_KEY_DERIVATION_KEY_ROW1_LSB_ADDR A:0x6005c060
y.create.l HWIO_QFPROM_CORR_PRI_KEY_DERIVATION_KEY_ROW2_LSB_ADDR A:0x6005c068
y.create.l HWIO_QFPROM_CORR_PRI_KEY_DERIVATION_KEY_ROW3_LSB_ADDR A:0x6005c070
y.create.l HWIO_QFPROM_CORR_PRI_KEY_DERIVATION_KEY_ROW0_MSB_ADDR A:0x6005c05c
y.create.l HWIO_QFPROM_CORR_PRI_KEY_DERIVATION_KEY_ROW1_MSB_ADDR A:0x6005c064
y.create.l HWIO_QFPROM_CORR_PRI_KEY_DERIVATION_KEY_ROW2_MSB_ADDR A:0x6005c06c
y.create.l HWIO_QFPROM_CORR_PRI_KEY_DERIVATION_KEY_ROW3_MSB_ADDR A:0x6005c074
y.create.l HWIO_QFPROM_CORR_SEC_KEY_DERIVATION_KEY_ROW0_LSB_ADDR A:0x6005c078
y.create.l HWIO_QFPROM_CORR_SEC_KEY_DERIVATION_KEY_ROW1_LSB_ADDR A:0x6005c080
y.create.l HWIO_QFPROM_CORR_SEC_KEY_DERIVATION_KEY_ROW2_LSB_ADDR A:0x6005c088
y.create.l HWIO_QFPROM_CORR_SEC_KEY_DERIVATION_KEY_ROW3_LSB_ADDR A:0x6005c090
y.create.l HWIO_QFPROM_CORR_SEC_KEY_DERIVATION_KEY_ROW0_MSB_ADDR A:0x6005c07c
y.create.l HWIO_QFPROM_CORR_SEC_KEY_DERIVATION_KEY_ROW1_MSB_ADDR A:0x6005c084
y.create.l HWIO_QFPROM_CORR_SEC_KEY_DERIVATION_KEY_ROW2_MSB_ADDR A:0x6005c08c
y.create.l HWIO_QFPROM_CORR_SEC_KEY_DERIVATION_KEY_ROW3_MSB_ADDR A:0x6005c094
y.create.l HWIO_QFPROM_CORR_OEM_SEC_BOOT_ROW0_LSB_ADDR A:0x6005c098
y.create.l HWIO_QFPROM_CORR_OEM_SEC_BOOT_ROW0_MSB_ADDR A:0x6005c09c
y.create.l HWIO_QFPROM_CORR_QC_SEC_BOOT_ROW0_LSB_ADDR A:0x6005c0a0
y.create.l HWIO_QFPROM_CORR_QC_SEC_BOOT_ROW0_MSB_ADDR A:0x6005c0a4
y.create.l HWIO_QFPROM_CORR_PK_HASH_ROW0_LSB_ADDR A:0x6005c0a8
y.create.l HWIO_QFPROM_CORR_PK_HASH_ROW1_LSB_ADDR A:0x6005c0b0
y.create.l HWIO_QFPROM_CORR_PK_HASH_ROW2_LSB_ADDR A:0x6005c0b8
y.create.l HWIO_QFPROM_CORR_PK_HASH_ROW3_LSB_ADDR A:0x6005c0c0
y.create.l HWIO_QFPROM_CORR_PK_HASH_ROW0_MSB_ADDR A:0x6005c0ac
y.create.l HWIO_QFPROM_CORR_PK_HASH_ROW1_MSB_ADDR A:0x6005c0b4
y.create.l HWIO_QFPROM_CORR_PK_HASH_ROW2_MSB_ADDR A:0x6005c0bc
y.create.l HWIO_QFPROM_CORR_PK_HASH_ROW3_MSB_ADDR A:0x6005c0c4
y.create.l HWIO_QFPROM_CORR_PK_HASH_ROW4_LSB_ADDR A:0x6005c0c8
y.create.l HWIO_QFPROM_CORR_PK_HASH_ROW4_MSB_ADDR A:0x6005c0cc
y.create.l HWIO_QFPROM_CORR_CALIB_ROW0_LSB_ADDR A:0x6005c0d0
y.create.l HWIO_QFPROM_CORR_CALIB_ROW0_MSB_ADDR A:0x6005c0d4
y.create.l HWIO_QFPROM_CORR_CALIB_ROW1_LSB_ADDR A:0x6005c0d8
y.create.l HWIO_QFPROM_CORR_CALIB_ROW1_MSB_ADDR A:0x6005c0dc
y.create.l HWIO_QFPROM_CORR_CALIB_ROW2_LSB_ADDR A:0x6005c0e0
y.create.l HWIO_QFPROM_CORR_CALIB_ROW2_MSB_ADDR A:0x6005c0e4
y.create.l HWIO_QFPROM_CORR_CALIB_ROW3_LSB_ADDR A:0x6005c0e8
y.create.l HWIO_QFPROM_CORR_CALIB_ROW3_MSB_ADDR A:0x6005c0ec
y.create.l HWIO_QFPROM_CORR_CALIB_ROW4_LSB_ADDR A:0x6005c0f0
y.create.l HWIO_QFPROM_CORR_CALIB_ROW4_MSB_ADDR A:0x6005c0f4
y.create.l HWIO_QFPROM_CORR_CALIB_ROW5_LSB_ADDR A:0x6005c0f8
y.create.l HWIO_QFPROM_CORR_CALIB_ROW5_MSB_ADDR A:0x6005c0fc
y.create.l HWIO_QFPROM_CORR_CALIB_ROW6_LSB_ADDR A:0x6005c100
y.create.l HWIO_QFPROM_CORR_CALIB_ROW6_MSB_ADDR A:0x6005c104
y.create.l HWIO_QFPROM_CORR_MEM_CONFIG_ROW0_LSB_ADDR A:0x6005c108
y.create.l HWIO_QFPROM_CORR_MEM_CONFIG_ROW1_LSB_ADDR A:0x6005c110
y.create.l HWIO_QFPROM_CORR_MEM_CONFIG_ROW2_LSB_ADDR A:0x6005c118
y.create.l HWIO_QFPROM_CORR_MEM_CONFIG_ROW3_LSB_ADDR A:0x6005c120
y.create.l HWIO_QFPROM_CORR_MEM_CONFIG_ROW4_LSB_ADDR A:0x6005c128
y.create.l HWIO_QFPROM_CORR_MEM_CONFIG_ROW5_LSB_ADDR A:0x6005c130
y.create.l HWIO_QFPROM_CORR_MEM_CONFIG_ROW6_LSB_ADDR A:0x6005c138
y.create.l HWIO_QFPROM_CORR_MEM_CONFIG_ROW7_LSB_ADDR A:0x6005c140
y.create.l HWIO_QFPROM_CORR_MEM_CONFIG_ROW8_LSB_ADDR A:0x6005c148
y.create.l HWIO_QFPROM_CORR_MEM_CONFIG_ROW9_LSB_ADDR A:0x6005c150
y.create.l HWIO_QFPROM_CORR_MEM_CONFIG_ROW0_MSB_ADDR A:0x6005c10c
y.create.l HWIO_QFPROM_CORR_MEM_CONFIG_ROW1_MSB_ADDR A:0x6005c114
y.create.l HWIO_QFPROM_CORR_MEM_CONFIG_ROW2_MSB_ADDR A:0x6005c11c
y.create.l HWIO_QFPROM_CORR_MEM_CONFIG_ROW3_MSB_ADDR A:0x6005c124
y.create.l HWIO_QFPROM_CORR_MEM_CONFIG_ROW4_MSB_ADDR A:0x6005c12c
y.create.l HWIO_QFPROM_CORR_MEM_CONFIG_ROW5_MSB_ADDR A:0x6005c134
y.create.l HWIO_QFPROM_CORR_MEM_CONFIG_ROW6_MSB_ADDR A:0x6005c13c
y.create.l HWIO_QFPROM_CORR_MEM_CONFIG_ROW7_MSB_ADDR A:0x6005c144
y.create.l HWIO_QFPROM_CORR_MEM_CONFIG_ROW8_MSB_ADDR A:0x6005c14c
y.create.l HWIO_QFPROM_CORR_MEM_CONFIG_ROW9_MSB_ADDR A:0x6005c154
y.create.l HWIO_QFPROM_CORR_MEM_CONFIG_ROW16_LSB_ADDR A:0x6005c188
y.create.l HWIO_QFPROM_CORR_MEM_CONFIG_ROW16_MSB_ADDR A:0x6005c18c
y.create.l HWIO_QFPROM_CORR_MEM_CONFIG_ROW17_LSB_ADDR A:0x6005c190
y.create.l HWIO_QFPROM_CORR_MEM_CONFIG_ROW17_MSB_ADDR A:0x6005c194
y.create.l HWIO_QFPROM_CORR_MEM_CONFIG_ROW18_LSB_ADDR A:0x6005c198
y.create.l HWIO_QFPROM_CORR_MEM_CONFIG_ROW18_MSB_ADDR A:0x6005c19c
y.create.l HWIO_QFPROM_CORR_MEM_CONFIG_ROW19_LSB_ADDR A:0x6005c1a0
y.create.l HWIO_QFPROM_CORR_MEM_CONFIG_ROW19_MSB_ADDR A:0x6005c1a4
y.create.l HWIO_QFPROM_CORR_MEM_CONFIG_ROW20_LSB_ADDR A:0x6005c1a8
y.create.l HWIO_QFPROM_CORR_MEM_CONFIG_ROW20_MSB_ADDR A:0x6005c1ac
y.create.l HWIO_QFPROM_CORR_ROM_PATCH_ROW0_LSB_ADDR A:0x6005c1b0
y.create.l HWIO_QFPROM_CORR_ROM_PATCH_ROW1_LSB_ADDR A:0x6005c1b8
y.create.l HWIO_QFPROM_CORR_ROM_PATCH_ROW2_LSB_ADDR A:0x6005c1c0
y.create.l HWIO_QFPROM_CORR_ROM_PATCH_ROW3_LSB_ADDR A:0x6005c1c8
y.create.l HWIO_QFPROM_CORR_ROM_PATCH_ROW4_LSB_ADDR A:0x6005c1d0
y.create.l HWIO_QFPROM_CORR_ROM_PATCH_ROW5_LSB_ADDR A:0x6005c1d8
y.create.l HWIO_QFPROM_CORR_ROM_PATCH_ROW6_LSB_ADDR A:0x6005c1e0
y.create.l HWIO_QFPROM_CORR_ROM_PATCH_ROW7_LSB_ADDR A:0x6005c1e8
y.create.l HWIO_QFPROM_CORR_ROM_PATCH_ROW8_LSB_ADDR A:0x6005c1f0
y.create.l HWIO_QFPROM_CORR_ROM_PATCH_ROW9_LSB_ADDR A:0x6005c1f8
y.create.l HWIO_QFPROM_CORR_ROM_PATCH_ROW0_MSB_ADDR A:0x6005c1b4
y.create.l HWIO_QFPROM_CORR_ROM_PATCH_ROW1_MSB_ADDR A:0x6005c1bc
y.create.l HWIO_QFPROM_CORR_ROM_PATCH_ROW2_MSB_ADDR A:0x6005c1c4
y.create.l HWIO_QFPROM_CORR_ROM_PATCH_ROW3_MSB_ADDR A:0x6005c1cc
y.create.l HWIO_QFPROM_CORR_ROM_PATCH_ROW4_MSB_ADDR A:0x6005c1d4
y.create.l HWIO_QFPROM_CORR_ROM_PATCH_ROW5_MSB_ADDR A:0x6005c1dc
y.create.l HWIO_QFPROM_CORR_ROM_PATCH_ROW6_MSB_ADDR A:0x6005c1e4
y.create.l HWIO_QFPROM_CORR_ROM_PATCH_ROW7_MSB_ADDR A:0x6005c1ec
y.create.l HWIO_QFPROM_CORR_ROM_PATCH_ROW8_MSB_ADDR A:0x6005c1f4
y.create.l HWIO_QFPROM_CORR_ROM_PATCH_ROW9_MSB_ADDR A:0x6005c1fc
y.create.l HWIO_QFPROM_CORR_FEC_EN_LSB_ADDR A:0x6005c2b0
y.create.l HWIO_QFPROM_CORR_FEC_EN_MSB_ADDR A:0x6005c2b4
y.create.l HWIO_QFPROM_CORR_SPARE_REG16_LSB_ADDR A:0x6005c2b8
y.create.l HWIO_QFPROM_CORR_SPARE_REG16_MSB_ADDR A:0x6005c2bc
y.create.l HWIO_QFPROM_CORR_SPARE_REG17_LSB_ADDR A:0x6005c2c0
y.create.l HWIO_QFPROM_CORR_SPARE_REG17_MSB_ADDR A:0x6005c2c4
y.create.l HWIO_QFPROM_CORR_SPARE_REG18_LSB_ADDR A:0x6005c2c8
y.create.l HWIO_QFPROM_CORR_SPARE_REG18_MSB_ADDR A:0x6005c2cc
y.create.l HWIO_QFPROM_CORR_SPARE_REG19_LSB_ADDR A:0x6005c2d0
y.create.l HWIO_QFPROM_CORR_SPARE_REG19_MSB_ADDR A:0x6005c2d4
y.create.l HWIO_QFPROM_CORR_SPARE_REG20_LSB_ADDR A:0x6005c2d8
y.create.l HWIO_QFPROM_CORR_SPARE_REG20_MSB_ADDR A:0x6005c2dc
y.create.l HWIO_QFPROM_CORR_SPARE_REG21_LSB_ADDR A:0x6005c2e0
y.create.l HWIO_QFPROM_CORR_SPARE_REG21_MSB_ADDR A:0x6005c2e4
y.create.l HWIO_QFPROM_CORR_ACC_PRIVATE0_ADDR A:0x6005c400
y.create.l HWIO_QFPROM_CORR_ACC_PRIVATE1_ADDR A:0x6005c404
y.create.l HWIO_QFPROM_CORR_ACC_PRIVATE2_ADDR A:0x6005c408
y.create.l HWIO_QFPROM_CORR_ACC_PRIVATE3_ADDR A:0x6005c40c
y.create.l HWIO_QFPROM_CORR_ACC_PRIVATE4_ADDR A:0x6005c410
y.create.l HWIO_QFPROM_CORR_ACC_PRIVATE5_ADDR A:0x6005c414
y.create.l HWIO_QFPROM_CORR_ACC_PRIVATE6_ADDR A:0x6005c418
y.create.l HWIO_QFPROM_CORR_ACC_PRIVATE7_ADDR A:0x6005c41c
y.create.l HWIO_QFPROM_CORR_ACC_PRIVATE8_ADDR A:0x6005c420
y.create.l HWIO_QFPROM_CORR_ACC_PRIVATE9_ADDR A:0x6005c424
y.create.l HWIO_SEC_CTRL_HW_VERSION_ADDR A:0x6005e000
y.create.l HWIO_FEATURE_CONFIG0_ADDR A:0x6005e004
y.create.l HWIO_FEATURE_CONFIG1_ADDR A:0x6005e008
y.create.l HWIO_FEATURE_CONFIG2_ADDR A:0x6005e00c
y.create.l HWIO_FEATURE_CONFIG3_ADDR A:0x6005e010
y.create.l HWIO_FEATURE_CONFIG4_ADDR A:0x6005e014
y.create.l HWIO_FEATURE_CONFIG5_ADDR A:0x6005e018
y.create.l HWIO_OEM_CONFIG0_ADDR A:0x6005e01c
y.create.l HWIO_OEM_CONFIG1_ADDR A:0x6005e020
y.create.l HWIO_OEM_CONFIG2_ADDR A:0x6005e024
y.create.l HWIO_OEM_CONFIG3_ADDR A:0x6005e028
y.create.l HWIO_BOOT_CONFIG_ADDR A:0x6005e02c
y.create.l HWIO_SECURE_BOOT1_ADDR A:0x6005e034
y.create.l HWIO_SECURE_BOOT2_ADDR A:0x6005e038
y.create.l HWIO_SECURE_BOOT3_ADDR A:0x6005e03c
y.create.l HWIO_SECURE_BOOT4_ADDR A:0x6005e040
y.create.l HWIO_SECURE_BOOT5_ADDR A:0x6005e044
y.create.l HWIO_SECURE_BOOT6_ADDR A:0x6005e048
y.create.l HWIO_SECURE_BOOT7_ADDR A:0x6005e04c
y.create.l HWIO_OVERRIDE_0_ADDR A:0x6005e058
y.create.l HWIO_OVERRIDE_1_ADDR A:0x6005e05c
y.create.l HWIO_OVERRIDE_2_ADDR A:0x6005e060
y.create.l HWIO_OVERRIDE_3_ADDR A:0x6005e064
y.create.l HWIO_OVERRIDE_4_ADDR A:0x6005e068
y.create.l HWIO_CAPT_SEC_GPIO_ADDR A:0x6005e06c
y.create.l HWIO_APP_PROC_CFG_ADDR A:0x6005e070
y.create.l HWIO_MSS_PROC_CFG_ADDR A:0x6005e074
y.create.l HWIO_QFPROM_CLK_CTL_ADDR A:0x6005e078
y.create.l HWIO_JTAG_ID_ADDR A:0x6005e07c
y.create.l HWIO_OEM_ID_ADDR A:0x6005e080
y.create.l HWIO_TEST_BUS_SEL_ADDR A:0x6005e084
y.create.l HWIO_SPDM_DYN_SECURE_MODE_ADDR A:0x6005e088
y.create.l HWIO_SEC_CTRL_APU_XPU_SCR_ADDR A:0x6005f000
y.create.l HWIO_SEC_CTRL_APU_XPU_SWDR_ADDR A:0x6005f004
y.create.l HWIO_SEC_CTRL_APU_XPU_SEAR0_ADDR A:0x6005f040
y.create.l HWIO_SEC_CTRL_APU_XPU_SESR_ADDR A:0x6005f048
y.create.l HWIO_SEC_CTRL_APU_XPU_SESRRESTORE_ADDR A:0x6005f04c
y.create.l HWIO_SEC_CTRL_APU_XPU_SESYNR0_ADDR A:0x6005f050
y.create.l HWIO_SEC_CTRL_APU_XPU_SESYNR1_ADDR A:0x6005f054
y.create.l HWIO_SEC_CTRL_APU_XPU_SESYNR2_ADDR A:0x6005f058
y.create.l HWIO_SEC_CTRL_APU_XPU_MCR_ADDR A:0x6005f100
y.create.l HWIO_SEC_CTRL_APU_XPU_MEAR0_ADDR A:0x6005f140
y.create.l HWIO_SEC_CTRL_APU_XPU_MESR_ADDR A:0x6005f148
y.create.l HWIO_SEC_CTRL_APU_XPU_MESRRESTORE_ADDR A:0x6005f14c
y.create.l HWIO_SEC_CTRL_APU_XPU_MESYNR0_ADDR A:0x6005f150
y.create.l HWIO_SEC_CTRL_APU_XPU_MESYNR1_ADDR A:0x6005f154
y.create.l HWIO_SEC_CTRL_APU_XPU_MESYNR2_ADDR A:0x6005f158
y.create.l HWIO_SEC_CTRL_APU_XPU_CR_ADDR A:0x6005f080
y.create.l HWIO_SEC_CTRL_APU_XPU_RPU_ACR0_ADDR A:0x6005f0a0
y.create.l HWIO_SEC_CTRL_APU_XPU_EAR0_ADDR A:0x6005f0c0
y.create.l HWIO_SEC_CTRL_APU_XPU_ESR_ADDR A:0x6005f0c8
y.create.l HWIO_SEC_CTRL_APU_XPU_ESRRESTORE_ADDR A:0x6005f0cc
y.create.l HWIO_SEC_CTRL_APU_XPU_ESYNR0_ADDR A:0x6005f0d0
y.create.l HWIO_SEC_CTRL_APU_XPU_ESYNR1_ADDR A:0x6005f0d4
y.create.l HWIO_SEC_CTRL_APU_XPU_ESYNR2_ADDR A:0x6005f0d8
y.create.l HWIO_SEC_CTRL_APU_XPU_IDR0_ADDR A:0x6005f074
y.create.l HWIO_SEC_CTRL_APU_XPU_IDR1_ADDR A:0x6005f078
y.create.l HWIO_SEC_CTRL_APU_XPU_REV_ADDR A:0x6005f07c
y.create.l HWIO_SEC_CTRL_APU_XPU_RG0_RACR0_ADDR A:0x6005f200
y.create.l HWIO_SEC_CTRL_APU_XPU_RG1_RACR0_ADDR A:0x6005f280
y.create.l HWIO_SEC_CTRL_APU_XPU_RG2_RACR0_ADDR A:0x6005f300
y.create.l HWIO_SEC_CTRL_APU_XPU_RG3_RACR0_ADDR A:0x6005f380
y.create.l HWIO_SEC_CTRL_APU_XPU_RG4_RACR0_ADDR A:0x6005f400
y.create.l HWIO_SEC_CTRL_APU_XPU_RG5_RACR0_ADDR A:0x6005f480
y.create.l HWIO_SEC_CTRL_APU_XPU_RG6_RACR0_ADDR A:0x6005f500
y.create.l HWIO_SEC_CTRL_APU_XPU_RG7_RACR0_ADDR A:0x6005f580
y.create.l HWIO_SEC_CTRL_APU_XPU_RG8_RACR0_ADDR A:0x6005f600
y.create.l HWIO_SEC_CTRL_APU_XPU_RG9_RACR0_ADDR A:0x6005f680
y.create.l HWIO_SEC_CTRL_APU_XPU_RG0_WACR0_ADDR A:0x6005f220
y.create.l HWIO_SEC_CTRL_APU_XPU_RG1_WACR0_ADDR A:0x6005f2a0
y.create.l HWIO_SEC_CTRL_APU_XPU_RG2_WACR0_ADDR A:0x6005f320
y.create.l HWIO_SEC_CTRL_APU_XPU_RG3_WACR0_ADDR A:0x6005f3a0
y.create.l HWIO_SEC_CTRL_APU_XPU_RG4_WACR0_ADDR A:0x6005f420
y.create.l HWIO_SEC_CTRL_APU_XPU_RG5_WACR0_ADDR A:0x6005f4a0
y.create.l HWIO_SEC_CTRL_APU_XPU_RG6_WACR0_ADDR A:0x6005f520
y.create.l HWIO_SEC_CTRL_APU_XPU_RG7_WACR0_ADDR A:0x6005f5a0
y.create.l HWIO_SEC_CTRL_APU_XPU_RG8_WACR0_ADDR A:0x6005f620
y.create.l HWIO_SEC_CTRL_APU_XPU_RG9_WACR0_ADDR A:0x6005f6a0
y.create.l HWIO_SEC_CTRL_APU_XPU_RG0_SCR_ADDR A:0x6005f250
y.create.l HWIO_SEC_CTRL_APU_XPU_RG1_SCR_ADDR A:0x6005f2d0
y.create.l HWIO_SEC_CTRL_APU_XPU_RG2_SCR_ADDR A:0x6005f350
y.create.l HWIO_SEC_CTRL_APU_XPU_RG3_SCR_ADDR A:0x6005f3d0
y.create.l HWIO_SEC_CTRL_APU_XPU_RG4_SCR_ADDR A:0x6005f450
y.create.l HWIO_SEC_CTRL_APU_XPU_RG5_SCR_ADDR A:0x6005f4d0
y.create.l HWIO_SEC_CTRL_APU_XPU_RG6_SCR_ADDR A:0x6005f550
y.create.l HWIO_SEC_CTRL_APU_XPU_RG7_SCR_ADDR A:0x6005f5d0
y.create.l HWIO_SEC_CTRL_APU_XPU_RG8_SCR_ADDR A:0x6005f650
y.create.l HWIO_SEC_CTRL_APU_XPU_RG9_SCR_ADDR A:0x6005f6d0
y.create.l HWIO_SEC_CTRL_APU_XPU_RG0_MCR_ADDR A:0x6005f254
y.create.l HWIO_SEC_CTRL_APU_XPU_RG1_MCR_ADDR A:0x6005f2d4
y.create.l HWIO_SEC_CTRL_APU_XPU_RG2_MCR_ADDR A:0x6005f354
y.create.l HWIO_SEC_CTRL_APU_XPU_RG3_MCR_ADDR A:0x6005f3d4
y.create.l HWIO_SEC_CTRL_APU_XPU_RG4_MCR_ADDR A:0x6005f454
y.create.l HWIO_SEC_CTRL_APU_XPU_RG5_MCR_ADDR A:0x6005f4d4
y.create.l HWIO_SEC_CTRL_APU_XPU_RG6_MCR_ADDR A:0x6005f554
y.create.l HWIO_SEC_CTRL_APU_XPU_RG7_MCR_ADDR A:0x6005f5d4
y.create.l HWIO_SEC_CTRL_APU_XPU_RG8_MCR_ADDR A:0x6005f654
y.create.l HWIO_SEC_CTRL_APU_XPU_RG9_MCR_ADDR A:0x6005f6d4
y.create.l HWIO_TCU_XPU_SCR_TCU_ADDR A:0x60034000
y.create.l HWIO_TCU_XPU_SWDR_TCU_ADDR A:0x60034004
y.create.l HWIO_TCU_XPU_PRTN_RACR_SSHADOW_TCU_ADDR A:0x60034008
y.create.l HWIO_TCU_XPU_PRTN_WACR_SSHADOW_TCU_ADDR A:0x6003400c
y.create.l HWIO_TCU_XPU_PRTN_START_SSHADOW0_TCU_ADDR A:0x60034010
y.create.l HWIO_TCU_XPU_PRTN_END_SSHADOW0_TCU_ADDR A:0x60034018
y.create.l HWIO_TCU_XPU_SEAR0_TCU_ADDR A:0x60034040
y.create.l HWIO_TCU_XPU_SESR_TCU_ADDR A:0x60034048
y.create.l HWIO_TCU_XPU_SESRRESTORE_TCU_ADDR A:0x6003404c
y.create.l HWIO_TCU_XPU_SESYNR0_TCU_ADDR A:0x60034050
y.create.l HWIO_TCU_XPU_SESYNR1_TCU_ADDR A:0x60034054
y.create.l HWIO_TCU_XPU_SESYNR2_TCU_ADDR A:0x60034058
y.create.l HWIO_TCU_XPU_MCR_TCU_ADDR A:0x60034100
y.create.l HWIO_TCU_XPU_MEAR0_TCU_ADDR A:0x60034140
y.create.l HWIO_TCU_XPU_MESR_TCU_ADDR A:0x60034148
y.create.l HWIO_TCU_XPU_MESRRESTORE_TCU_ADDR A:0x6003414c
y.create.l HWIO_TCU_XPU_MESYNR0_TCU_ADDR A:0x60034150
y.create.l HWIO_TCU_XPU_MESYNR1_TCU_ADDR A:0x60034154
y.create.l HWIO_TCU_XPU_MESYNR2_TCU_ADDR A:0x60034158
y.create.l HWIO_TCU_XPU_CR_TCU_ADDR A:0x60034080
y.create.l HWIO_TCU_XPU_PRTN_RACR_SHADOW_TCU_ADDR A:0x60034088
y.create.l HWIO_TCU_XPU_PRTN_WACR_SHADOW_TCU_ADDR A:0x6003408c
y.create.l HWIO_TCU_XPU_PRTN_START_SHADOW0_TCU_ADDR A:0x60034090
y.create.l HWIO_TCU_XPU_PRTN_END_SHADOW0_TCU_ADDR A:0x60034098
y.create.l HWIO_TCU_XPU_RPU_ACR0_TCU_ADDR A:0x600340a0
y.create.l HWIO_TCU_XPU_EAR0_TCU_ADDR A:0x600340c0
y.create.l HWIO_TCU_XPU_ESR_TCU_ADDR A:0x600340c8
y.create.l HWIO_TCU_XPU_ESRRESTORE_TCU_ADDR A:0x600340cc
y.create.l HWIO_TCU_XPU_ESYNR0_TCU_ADDR A:0x600340d0
y.create.l HWIO_TCU_XPU_ESYNR1_TCU_ADDR A:0x600340d4
y.create.l HWIO_TCU_XPU_ESYNR2_TCU_ADDR A:0x600340d8
y.create.l HWIO_TCU_XPU_UMR_RACR_TCU_ADDR A:0x600340e0
y.create.l HWIO_TCU_XPU_UMR_WACR_TCU_ADDR A:0x600340e4
y.create.l HWIO_TCU_XPU_UMR_CNTL_TCU_ADDR A:0x600340f0
y.create.l HWIO_TCU_XPU_IDR0_TCU_ADDR A:0x60034074
y.create.l HWIO_TCU_XPU_IDR1_TCU_ADDR A:0x60034078
y.create.l HWIO_TCU_XPU_REV_TCU_ADDR A:0x6003407c
y.create.l HWIO_TCU_XPU_PRT0_RACR0_TCU_ADDR A:0x60034200
y.create.l HWIO_TCU_XPU_PRT1_RACR0_TCU_ADDR A:0x60034280
y.create.l HWIO_TCU_XPU_PRT2_RACR0_TCU_ADDR A:0x60034300
y.create.l HWIO_TCU_XPU_PRT3_RACR0_TCU_ADDR A:0x60034380
y.create.l HWIO_TCU_XPU_PRT4_RACR0_TCU_ADDR A:0x60034400
y.create.l HWIO_TCU_XPU_PRT5_RACR0_TCU_ADDR A:0x60034480
y.create.l HWIO_TCU_XPU_PRT6_RACR0_TCU_ADDR A:0x60034500
y.create.l HWIO_TCU_XPU_PRT7_RACR0_TCU_ADDR A:0x60034580
y.create.l HWIO_TCU_XPU_PRT8_RACR0_TCU_ADDR A:0x60034600
y.create.l HWIO_TCU_XPU_PRT9_RACR0_TCU_ADDR A:0x60034680
y.create.l HWIO_TCU_XPU_PRT0_WACR0_TCU_ADDR A:0x60034220
y.create.l HWIO_TCU_XPU_PRT1_WACR0_TCU_ADDR A:0x600342a0
y.create.l HWIO_TCU_XPU_PRT2_WACR0_TCU_ADDR A:0x60034320
y.create.l HWIO_TCU_XPU_PRT3_WACR0_TCU_ADDR A:0x600343a0
y.create.l HWIO_TCU_XPU_PRT4_WACR0_TCU_ADDR A:0x60034420
y.create.l HWIO_TCU_XPU_PRT5_WACR0_TCU_ADDR A:0x600344a0
y.create.l HWIO_TCU_XPU_PRT6_WACR0_TCU_ADDR A:0x60034520
y.create.l HWIO_TCU_XPU_PRT7_WACR0_TCU_ADDR A:0x600345a0
y.create.l HWIO_TCU_XPU_PRT8_WACR0_TCU_ADDR A:0x60034620
y.create.l HWIO_TCU_XPU_PRT9_WACR0_TCU_ADDR A:0x600346a0
y.create.l HWIO_TCU_XPU_PRT0_START0_TCU_ADDR A:0x60034240
y.create.l HWIO_TCU_XPU_PRT1_START0_TCU_ADDR A:0x600342c0
y.create.l HWIO_TCU_XPU_PRT2_START0_TCU_ADDR A:0x60034340
y.create.l HWIO_TCU_XPU_PRT3_START0_TCU_ADDR A:0x600343c0
y.create.l HWIO_TCU_XPU_PRT4_START0_TCU_ADDR A:0x60034440
y.create.l HWIO_TCU_XPU_PRT5_START0_TCU_ADDR A:0x600344c0
y.create.l HWIO_TCU_XPU_PRT6_START0_TCU_ADDR A:0x60034540
y.create.l HWIO_TCU_XPU_PRT7_START0_TCU_ADDR A:0x600345c0
y.create.l HWIO_TCU_XPU_PRT8_START0_TCU_ADDR A:0x60034640
y.create.l HWIO_TCU_XPU_PRT9_START0_TCU_ADDR A:0x600346c0
y.create.l HWIO_TCU_XPU_PRT0_END0_TCU_ADDR A:0x60034248
y.create.l HWIO_TCU_XPU_PRT1_END0_TCU_ADDR A:0x600342c8
y.create.l HWIO_TCU_XPU_PRT2_END0_TCU_ADDR A:0x60034348
y.create.l HWIO_TCU_XPU_PRT3_END0_TCU_ADDR A:0x600343c8
y.create.l HWIO_TCU_XPU_PRT4_END0_TCU_ADDR A:0x60034448
y.create.l HWIO_TCU_XPU_PRT5_END0_TCU_ADDR A:0x600344c8
y.create.l HWIO_TCU_XPU_PRT6_END0_TCU_ADDR A:0x60034548
y.create.l HWIO_TCU_XPU_PRT7_END0_TCU_ADDR A:0x600345c8
y.create.l HWIO_TCU_XPU_PRT8_END0_TCU_ADDR A:0x60034648
y.create.l HWIO_TCU_XPU_PRT9_END0_TCU_ADDR A:0x600346c8
y.create.l HWIO_TCU_XPU_PRT0_SCR_TCU_ADDR A:0x60034250
y.create.l HWIO_TCU_XPU_PRT1_SCR_TCU_ADDR A:0x600342d0
y.create.l HWIO_TCU_XPU_PRT2_SCR_TCU_ADDR A:0x60034350
y.create.l HWIO_TCU_XPU_PRT3_SCR_TCU_ADDR A:0x600343d0
y.create.l HWIO_TCU_XPU_PRT4_SCR_TCU_ADDR A:0x60034450
y.create.l HWIO_TCU_XPU_PRT5_SCR_TCU_ADDR A:0x600344d0
y.create.l HWIO_TCU_XPU_PRT6_SCR_TCU_ADDR A:0x60034550
y.create.l HWIO_TCU_XPU_PRT7_SCR_TCU_ADDR A:0x600345d0
y.create.l HWIO_TCU_XPU_PRT8_SCR_TCU_ADDR A:0x60034650
y.create.l HWIO_TCU_XPU_PRT9_SCR_TCU_ADDR A:0x600346d0
y.create.l HWIO_TCU_XPU_PRT0_MCR_TCU_ADDR A:0x60034254
y.create.l HWIO_TCU_XPU_PRT1_MCR_TCU_ADDR A:0x600342d4
y.create.l HWIO_TCU_XPU_PRT2_MCR_TCU_ADDR A:0x60034354
y.create.l HWIO_TCU_XPU_PRT3_MCR_TCU_ADDR A:0x600343d4
y.create.l HWIO_TCU_XPU_PRT4_MCR_TCU_ADDR A:0x60034454
y.create.l HWIO_TCU_XPU_PRT5_MCR_TCU_ADDR A:0x600344d4
y.create.l HWIO_TCU_XPU_PRT6_MCR_TCU_ADDR A:0x60034554
y.create.l HWIO_TCU_XPU_PRT7_MCR_TCU_ADDR A:0x600345d4
y.create.l HWIO_TCU_XPU_PRT8_MCR_TCU_ADDR A:0x60034654
y.create.l HWIO_TCU_XPU_PRT9_MCR_TCU_ADDR A:0x600346d4
y.create.l HWIO_TCU_XPU_PRT0_CNTL0_TCU_ADDR A:0x60034258
y.create.l HWIO_TCU_XPU_PRT1_CNTL0_TCU_ADDR A:0x600342d8
y.create.l HWIO_TCU_XPU_PRT2_CNTL0_TCU_ADDR A:0x60034358
y.create.l HWIO_TCU_XPU_PRT3_CNTL0_TCU_ADDR A:0x600343d8
y.create.l HWIO_TCU_XPU_PRT4_CNTL0_TCU_ADDR A:0x60034458
y.create.l HWIO_TCU_XPU_PRT5_CNTL0_TCU_ADDR A:0x600344d8
y.create.l HWIO_TCU_XPU_PRT6_CNTL0_TCU_ADDR A:0x60034558
y.create.l HWIO_TCU_XPU_PRT7_CNTL0_TCU_ADDR A:0x600345d8
y.create.l HWIO_TCU_XPU_PRT8_CNTL0_TCU_ADDR A:0x60034658
y.create.l HWIO_TCU_XPU_PRT9_CNTL0_TCU_ADDR A:0x600346d8
y.create.l HWIO_TCU_XPU_PRT0_CNTL1_TCU_ADDR A:0x6003425c
y.create.l HWIO_TCU_XPU_PRT1_CNTL1_TCU_ADDR A:0x600342dc
y.create.l HWIO_TCU_XPU_PRT2_CNTL1_TCU_ADDR A:0x6003435c
y.create.l HWIO_TCU_XPU_PRT3_CNTL1_TCU_ADDR A:0x600343dc
y.create.l HWIO_TCU_XPU_PRT4_CNTL1_TCU_ADDR A:0x6003445c
y.create.l HWIO_TCU_XPU_PRT5_CNTL1_TCU_ADDR A:0x600344dc
y.create.l HWIO_TCU_XPU_PRT6_CNTL1_TCU_ADDR A:0x6003455c
y.create.l HWIO_TCU_XPU_PRT7_CNTL1_TCU_ADDR A:0x600345dc
y.create.l HWIO_TCU_XPU_PRT8_CNTL1_TCU_ADDR A:0x6003465c
y.create.l HWIO_TCU_XPU_PRT9_CNTL1_TCU_ADDR A:0x600346dc
y.create.l HWIO_DIME_XPU_SCR_DIME_ADDR A:0x60035000
y.create.l HWIO_DIME_XPU_SWDR_DIME_ADDR A:0x60035004
y.create.l HWIO_DIME_XPU_PRTN_RACR_SSHADOW_DIME_ADDR A:0x60035008
y.create.l HWIO_DIME_XPU_PRTN_START_SSHADOW0_DIME_ADDR A:0x60035010
y.create.l HWIO_DIME_XPU_PRTN_END_SSHADOW0_DIME_ADDR A:0x60035018
y.create.l HWIO_DIME_XPU_SEAR0_DIME_ADDR A:0x60035040
y.create.l HWIO_DIME_XPU_SESR_DIME_ADDR A:0x60035048
y.create.l HWIO_DIME_XPU_SESRRESTORE_DIME_ADDR A:0x6003504c
y.create.l HWIO_DIME_XPU_SESYNR0_DIME_ADDR A:0x60035050
y.create.l HWIO_DIME_XPU_SESYNR1_DIME_ADDR A:0x60035054
y.create.l HWIO_DIME_XPU_SESYNR2_DIME_ADDR A:0x60035058
y.create.l HWIO_DIME_XPU_MCR_DIME_ADDR A:0x60035100
y.create.l HWIO_DIME_XPU_MEAR0_DIME_ADDR A:0x60035140
y.create.l HWIO_DIME_XPU_MESR_DIME_ADDR A:0x60035148
y.create.l HWIO_DIME_XPU_MESRRESTORE_DIME_ADDR A:0x6003514c
y.create.l HWIO_DIME_XPU_MESYNR0_DIME_ADDR A:0x60035150
y.create.l HWIO_DIME_XPU_MESYNR1_DIME_ADDR A:0x60035154
y.create.l HWIO_DIME_XPU_MESYNR2_DIME_ADDR A:0x60035158
y.create.l HWIO_DIME_XPU_CR_DIME_ADDR A:0x60035080
y.create.l HWIO_DIME_XPU_PRTN_RACR_SHADOW_DIME_ADDR A:0x60035088
y.create.l HWIO_DIME_XPU_PRTN_START_SHADOW0_DIME_ADDR A:0x60035090
y.create.l HWIO_DIME_XPU_PRTN_END_SHADOW0_DIME_ADDR A:0x60035098
y.create.l HWIO_DIME_XPU_RPU_ACR0_DIME_ADDR A:0x600350a0
y.create.l HWIO_DIME_XPU_EAR0_DIME_ADDR A:0x600350c0
y.create.l HWIO_DIME_XPU_ESR_DIME_ADDR A:0x600350c8
y.create.l HWIO_DIME_XPU_ESRRESTORE_DIME_ADDR A:0x600350cc
y.create.l HWIO_DIME_XPU_ESYNR0_DIME_ADDR A:0x600350d0
y.create.l HWIO_DIME_XPU_ESYNR1_DIME_ADDR A:0x600350d4
y.create.l HWIO_DIME_XPU_ESYNR2_DIME_ADDR A:0x600350d8
y.create.l HWIO_DIME_XPU_UMR_RACR_DIME_ADDR A:0x600350e0
y.create.l HWIO_DIME_XPU_UMR_WACR_DIME_ADDR A:0x600350e4
y.create.l HWIO_DIME_XPU_UMR_CNTL_DIME_ADDR A:0x600350f0
y.create.l HWIO_DIME_XPU_IDR0_DIME_ADDR A:0x60035074
y.create.l HWIO_DIME_XPU_IDR1_DIME_ADDR A:0x60035078
y.create.l HWIO_DIME_XPU_REV_DIME_ADDR A:0x6003507c
y.create.l HWIO_DIME_XPU_PRT0_RACR0_DIME_ADDR A:0x60035200
y.create.l HWIO_DIME_XPU_PRT1_RACR0_DIME_ADDR A:0x60035280
y.create.l HWIO_DIME_XPU_PRT2_RACR0_DIME_ADDR A:0x60035300
y.create.l HWIO_DIME_XPU_PRT3_RACR0_DIME_ADDR A:0x60035380
y.create.l HWIO_DIME_XPU_PRT4_RACR0_DIME_ADDR A:0x60035400
y.create.l HWIO_DIME_XPU_PRT5_RACR0_DIME_ADDR A:0x60035480
y.create.l HWIO_DIME_XPU_PRT6_RACR0_DIME_ADDR A:0x60035500
y.create.l HWIO_DIME_XPU_PRT7_RACR0_DIME_ADDR A:0x60035580
y.create.l HWIO_DIME_XPU_PRT8_RACR0_DIME_ADDR A:0x60035600
y.create.l HWIO_DIME_XPU_PRT9_RACR0_DIME_ADDR A:0x60035680
y.create.l HWIO_DIME_XPU_PRT0_START0_DIME_ADDR A:0x60035240
y.create.l HWIO_DIME_XPU_PRT1_START0_DIME_ADDR A:0x600352c0
y.create.l HWIO_DIME_XPU_PRT2_START0_DIME_ADDR A:0x60035340
y.create.l HWIO_DIME_XPU_PRT3_START0_DIME_ADDR A:0x600353c0
y.create.l HWIO_DIME_XPU_PRT4_START0_DIME_ADDR A:0x60035440
y.create.l HWIO_DIME_XPU_PRT5_START0_DIME_ADDR A:0x600354c0
y.create.l HWIO_DIME_XPU_PRT6_START0_DIME_ADDR A:0x60035540
y.create.l HWIO_DIME_XPU_PRT7_START0_DIME_ADDR A:0x600355c0
y.create.l HWIO_DIME_XPU_PRT8_START0_DIME_ADDR A:0x60035640
y.create.l HWIO_DIME_XPU_PRT9_START0_DIME_ADDR A:0x600356c0
y.create.l HWIO_DIME_XPU_PRT0_END0_DIME_ADDR A:0x60035248
y.create.l HWIO_DIME_XPU_PRT1_END0_DIME_ADDR A:0x600352c8
y.create.l HWIO_DIME_XPU_PRT2_END0_DIME_ADDR A:0x60035348
y.create.l HWIO_DIME_XPU_PRT3_END0_DIME_ADDR A:0x600353c8
y.create.l HWIO_DIME_XPU_PRT4_END0_DIME_ADDR A:0x60035448
y.create.l HWIO_DIME_XPU_PRT5_END0_DIME_ADDR A:0x600354c8
y.create.l HWIO_DIME_XPU_PRT6_END0_DIME_ADDR A:0x60035548
y.create.l HWIO_DIME_XPU_PRT7_END0_DIME_ADDR A:0x600355c8
y.create.l HWIO_DIME_XPU_PRT8_END0_DIME_ADDR A:0x60035648
y.create.l HWIO_DIME_XPU_PRT9_END0_DIME_ADDR A:0x600356c8
y.create.l HWIO_DIME_XPU_PRT0_SCR_DIME_ADDR A:0x60035250
y.create.l HWIO_DIME_XPU_PRT1_SCR_DIME_ADDR A:0x600352d0
y.create.l HWIO_DIME_XPU_PRT2_SCR_DIME_ADDR A:0x60035350
y.create.l HWIO_DIME_XPU_PRT3_SCR_DIME_ADDR A:0x600353d0
y.create.l HWIO_DIME_XPU_PRT4_SCR_DIME_ADDR A:0x60035450
y.create.l HWIO_DIME_XPU_PRT5_SCR_DIME_ADDR A:0x600354d0
y.create.l HWIO_DIME_XPU_PRT6_SCR_DIME_ADDR A:0x60035550
y.create.l HWIO_DIME_XPU_PRT7_SCR_DIME_ADDR A:0x600355d0
y.create.l HWIO_DIME_XPU_PRT8_SCR_DIME_ADDR A:0x60035650
y.create.l HWIO_DIME_XPU_PRT9_SCR_DIME_ADDR A:0x600356d0
y.create.l HWIO_DIME_XPU_PRT0_MCR_DIME_ADDR A:0x60035254
y.create.l HWIO_DIME_XPU_PRT1_MCR_DIME_ADDR A:0x600352d4
y.create.l HWIO_DIME_XPU_PRT2_MCR_DIME_ADDR A:0x60035354
y.create.l HWIO_DIME_XPU_PRT3_MCR_DIME_ADDR A:0x600353d4
y.create.l HWIO_DIME_XPU_PRT4_MCR_DIME_ADDR A:0x60035454
y.create.l HWIO_DIME_XPU_PRT5_MCR_DIME_ADDR A:0x600354d4
y.create.l HWIO_DIME_XPU_PRT6_MCR_DIME_ADDR A:0x60035554
y.create.l HWIO_DIME_XPU_PRT7_MCR_DIME_ADDR A:0x600355d4
y.create.l HWIO_DIME_XPU_PRT8_MCR_DIME_ADDR A:0x60035654
y.create.l HWIO_DIME_XPU_PRT9_MCR_DIME_ADDR A:0x600356d4
y.create.l HWIO_DIME_XPU_PRT0_CNTL0_DIME_ADDR A:0x60035258
y.create.l HWIO_DIME_XPU_PRT1_CNTL0_DIME_ADDR A:0x600352d8
y.create.l HWIO_DIME_XPU_PRT2_CNTL0_DIME_ADDR A:0x60035358
y.create.l HWIO_DIME_XPU_PRT3_CNTL0_DIME_ADDR A:0x600353d8
y.create.l HWIO_DIME_XPU_PRT4_CNTL0_DIME_ADDR A:0x60035458
y.create.l HWIO_DIME_XPU_PRT5_CNTL0_DIME_ADDR A:0x600354d8
y.create.l HWIO_DIME_XPU_PRT6_CNTL0_DIME_ADDR A:0x60035558
y.create.l HWIO_DIME_XPU_PRT7_CNTL0_DIME_ADDR A:0x600355d8
y.create.l HWIO_DIME_XPU_PRT8_CNTL0_DIME_ADDR A:0x60035658
y.create.l HWIO_DIME_XPU_PRT9_CNTL0_DIME_ADDR A:0x600356d8
y.create.l HWIO_DIME_XPU_PRT0_CNTL1_DIME_ADDR A:0x6003525c
y.create.l HWIO_DIME_XPU_PRT1_CNTL1_DIME_ADDR A:0x600352dc
y.create.l HWIO_DIME_XPU_PRT2_CNTL1_DIME_ADDR A:0x6003535c
y.create.l HWIO_DIME_XPU_PRT3_CNTL1_DIME_ADDR A:0x600353dc
y.create.l HWIO_DIME_XPU_PRT4_CNTL1_DIME_ADDR A:0x6003545c
y.create.l HWIO_DIME_XPU_PRT5_CNTL1_DIME_ADDR A:0x600354dc
y.create.l HWIO_DIME_XPU_PRT6_CNTL1_DIME_ADDR A:0x6003555c
y.create.l HWIO_DIME_XPU_PRT7_CNTL1_DIME_ADDR A:0x600355dc
y.create.l HWIO_DIME_XPU_PRT8_CNTL1_DIME_ADDR A:0x6003565c
y.create.l HWIO_DIME_XPU_PRT9_CNTL1_DIME_ADDR A:0x600356dc
y.create.l HWIO_QDSP_XPU_SCR_QDSP_ADDR A:0x60036000
y.create.l HWIO_QDSP_XPU_SWDR_QDSP_ADDR A:0x60036004
y.create.l HWIO_QDSP_XPU_PRTN_RACR_SSHADOW_QDSP_ADDR A:0x60036008
y.create.l HWIO_QDSP_XPU_PRTN_START_SSHADOW0_QDSP_ADDR A:0x60036010
y.create.l HWIO_QDSP_XPU_PRTN_END_SSHADOW0_QDSP_ADDR A:0x60036018
y.create.l HWIO_QDSP_XPU_SEAR0_QDSP_ADDR A:0x60036040
y.create.l HWIO_QDSP_XPU_SESR_QDSP_ADDR A:0x60036048
y.create.l HWIO_QDSP_XPU_SESRRESTORE_QDSP_ADDR A:0x6003604c
y.create.l HWIO_QDSP_XPU_SESYNR0_QDSP_ADDR A:0x60036050
y.create.l HWIO_QDSP_XPU_SESYNR1_QDSP_ADDR A:0x60036054
y.create.l HWIO_QDSP_XPU_SESYNR2_QDSP_ADDR A:0x60036058
y.create.l HWIO_QDSP_XPU_MCR_QDSP_ADDR A:0x60036100
y.create.l HWIO_QDSP_XPU_MEAR0_QDSP_ADDR A:0x60036140
y.create.l HWIO_QDSP_XPU_MESR_QDSP_ADDR A:0x60036148
y.create.l HWIO_QDSP_XPU_MESRRESTORE_QDSP_ADDR A:0x6003614c
y.create.l HWIO_QDSP_XPU_MESYNR0_QDSP_ADDR A:0x60036150
y.create.l HWIO_QDSP_XPU_MESYNR1_QDSP_ADDR A:0x60036154
y.create.l HWIO_QDSP_XPU_MESYNR2_QDSP_ADDR A:0x60036158
y.create.l HWIO_QDSP_XPU_CR_QDSP_ADDR A:0x60036080
y.create.l HWIO_QDSP_XPU_PRTN_RACR_SHADOW_QDSP_ADDR A:0x60036088
y.create.l HWIO_QDSP_XPU_PRTN_START_SHADOW0_QDSP_ADDR A:0x60036090
y.create.l HWIO_QDSP_XPU_PRTN_END_SHADOW0_QDSP_ADDR A:0x60036098
y.create.l HWIO_QDSP_XPU_RPU_ACR0_QDSP_ADDR A:0x600360a0
y.create.l HWIO_QDSP_XPU_EAR0_QDSP_ADDR A:0x600360c0
y.create.l HWIO_QDSP_XPU_ESR_QDSP_ADDR A:0x600360c8
y.create.l HWIO_QDSP_XPU_ESRRESTORE_QDSP_ADDR A:0x600360cc
y.create.l HWIO_QDSP_XPU_ESYNR0_QDSP_ADDR A:0x600360d0
y.create.l HWIO_QDSP_XPU_ESYNR1_QDSP_ADDR A:0x600360d4
y.create.l HWIO_QDSP_XPU_ESYNR2_QDSP_ADDR A:0x600360d8
y.create.l HWIO_QDSP_XPU_UMR_RACR_QDSP_ADDR A:0x600360e0
y.create.l HWIO_QDSP_XPU_UMR_WACR_QDSP_ADDR A:0x600360e4
y.create.l HWIO_QDSP_XPU_UMR_CNTL_QDSP_ADDR A:0x600360f0
y.create.l HWIO_QDSP_XPU_IDR0_QDSP_ADDR A:0x60036074
y.create.l HWIO_QDSP_XPU_IDR1_QDSP_ADDR A:0x60036078
y.create.l HWIO_QDSP_XPU_REV_QDSP_ADDR A:0x6003607c
y.create.l HWIO_QDSP_XPU_PRT0_RACR0_QDSP_ADDR A:0x60036200
y.create.l HWIO_QDSP_XPU_PRT1_RACR0_QDSP_ADDR A:0x60036280
y.create.l HWIO_QDSP_XPU_PRT2_RACR0_QDSP_ADDR A:0x60036300
y.create.l HWIO_QDSP_XPU_PRT3_RACR0_QDSP_ADDR A:0x60036380
y.create.l HWIO_QDSP_XPU_PRT4_RACR0_QDSP_ADDR A:0x60036400
y.create.l HWIO_QDSP_XPU_PRT5_RACR0_QDSP_ADDR A:0x60036480
y.create.l HWIO_QDSP_XPU_PRT6_RACR0_QDSP_ADDR A:0x60036500
y.create.l HWIO_QDSP_XPU_PRT7_RACR0_QDSP_ADDR A:0x60036580
y.create.l HWIO_QDSP_XPU_PRT8_RACR0_QDSP_ADDR A:0x60036600
y.create.l HWIO_QDSP_XPU_PRT9_RACR0_QDSP_ADDR A:0x60036680
y.create.l HWIO_QDSP_XPU_PRT0_START0_QDSP_ADDR A:0x60036240
y.create.l HWIO_QDSP_XPU_PRT1_START0_QDSP_ADDR A:0x600362c0
y.create.l HWIO_QDSP_XPU_PRT2_START0_QDSP_ADDR A:0x60036340
y.create.l HWIO_QDSP_XPU_PRT3_START0_QDSP_ADDR A:0x600363c0
y.create.l HWIO_QDSP_XPU_PRT4_START0_QDSP_ADDR A:0x60036440
y.create.l HWIO_QDSP_XPU_PRT5_START0_QDSP_ADDR A:0x600364c0
y.create.l HWIO_QDSP_XPU_PRT6_START0_QDSP_ADDR A:0x60036540
y.create.l HWIO_QDSP_XPU_PRT7_START0_QDSP_ADDR A:0x600365c0
y.create.l HWIO_QDSP_XPU_PRT8_START0_QDSP_ADDR A:0x60036640
y.create.l HWIO_QDSP_XPU_PRT9_START0_QDSP_ADDR A:0x600366c0
y.create.l HWIO_QDSP_XPU_PRT0_END0_QDSP_ADDR A:0x60036248
y.create.l HWIO_QDSP_XPU_PRT1_END0_QDSP_ADDR A:0x600362c8
y.create.l HWIO_QDSP_XPU_PRT2_END0_QDSP_ADDR A:0x60036348
y.create.l HWIO_QDSP_XPU_PRT3_END0_QDSP_ADDR A:0x600363c8
y.create.l HWIO_QDSP_XPU_PRT4_END0_QDSP_ADDR A:0x60036448
y.create.l HWIO_QDSP_XPU_PRT5_END0_QDSP_ADDR A:0x600364c8
y.create.l HWIO_QDSP_XPU_PRT6_END0_QDSP_ADDR A:0x60036548
y.create.l HWIO_QDSP_XPU_PRT7_END0_QDSP_ADDR A:0x600365c8
y.create.l HWIO_QDSP_XPU_PRT8_END0_QDSP_ADDR A:0x60036648
y.create.l HWIO_QDSP_XPU_PRT9_END0_QDSP_ADDR A:0x600366c8
y.create.l HWIO_QDSP_XPU_PRT0_SCR_QDSP_ADDR A:0x60036250
y.create.l HWIO_QDSP_XPU_PRT1_SCR_QDSP_ADDR A:0x600362d0
y.create.l HWIO_QDSP_XPU_PRT2_SCR_QDSP_ADDR A:0x60036350
y.create.l HWIO_QDSP_XPU_PRT3_SCR_QDSP_ADDR A:0x600363d0
y.create.l HWIO_QDSP_XPU_PRT4_SCR_QDSP_ADDR A:0x60036450
y.create.l HWIO_QDSP_XPU_PRT5_SCR_QDSP_ADDR A:0x600364d0
y.create.l HWIO_QDSP_XPU_PRT6_SCR_QDSP_ADDR A:0x60036550
y.create.l HWIO_QDSP_XPU_PRT7_SCR_QDSP_ADDR A:0x600365d0
y.create.l HWIO_QDSP_XPU_PRT8_SCR_QDSP_ADDR A:0x60036650
y.create.l HWIO_QDSP_XPU_PRT9_SCR_QDSP_ADDR A:0x600366d0
y.create.l HWIO_QDSP_XPU_PRT0_MCR_QDSP_ADDR A:0x60036254
y.create.l HWIO_QDSP_XPU_PRT1_MCR_QDSP_ADDR A:0x600362d4
y.create.l HWIO_QDSP_XPU_PRT2_MCR_QDSP_ADDR A:0x60036354
y.create.l HWIO_QDSP_XPU_PRT3_MCR_QDSP_ADDR A:0x600363d4
y.create.l HWIO_QDSP_XPU_PRT4_MCR_QDSP_ADDR A:0x60036454
y.create.l HWIO_QDSP_XPU_PRT5_MCR_QDSP_ADDR A:0x600364d4
y.create.l HWIO_QDSP_XPU_PRT6_MCR_QDSP_ADDR A:0x60036554
y.create.l HWIO_QDSP_XPU_PRT7_MCR_QDSP_ADDR A:0x600365d4
y.create.l HWIO_QDSP_XPU_PRT8_MCR_QDSP_ADDR A:0x60036654
y.create.l HWIO_QDSP_XPU_PRT9_MCR_QDSP_ADDR A:0x600366d4
y.create.l HWIO_QDSP_XPU_PRT0_CNTL0_QDSP_ADDR A:0x60036258
y.create.l HWIO_QDSP_XPU_PRT1_CNTL0_QDSP_ADDR A:0x600362d8
y.create.l HWIO_QDSP_XPU_PRT2_CNTL0_QDSP_ADDR A:0x60036358
y.create.l HWIO_QDSP_XPU_PRT3_CNTL0_QDSP_ADDR A:0x600363d8
y.create.l HWIO_QDSP_XPU_PRT4_CNTL0_QDSP_ADDR A:0x60036458
y.create.l HWIO_QDSP_XPU_PRT5_CNTL0_QDSP_ADDR A:0x600364d8
y.create.l HWIO_QDSP_XPU_PRT6_CNTL0_QDSP_ADDR A:0x60036558
y.create.l HWIO_QDSP_XPU_PRT7_CNTL0_QDSP_ADDR A:0x600365d8
y.create.l HWIO_QDSP_XPU_PRT8_CNTL0_QDSP_ADDR A:0x60036658
y.create.l HWIO_QDSP_XPU_PRT9_CNTL0_QDSP_ADDR A:0x600366d8
y.create.l HWIO_QDSP_XPU_PRT0_CNTL1_QDSP_ADDR A:0x6003625c
y.create.l HWIO_QDSP_XPU_PRT1_CNTL1_QDSP_ADDR A:0x600362dc
y.create.l HWIO_QDSP_XPU_PRT2_CNTL1_QDSP_ADDR A:0x6003635c
y.create.l HWIO_QDSP_XPU_PRT3_CNTL1_QDSP_ADDR A:0x600363dc
y.create.l HWIO_QDSP_XPU_PRT4_CNTL1_QDSP_ADDR A:0x6003645c
y.create.l HWIO_QDSP_XPU_PRT5_CNTL1_QDSP_ADDR A:0x600364dc
y.create.l HWIO_QDSP_XPU_PRT6_CNTL1_QDSP_ADDR A:0x6003655c
y.create.l HWIO_QDSP_XPU_PRT7_CNTL1_QDSP_ADDR A:0x600365dc
y.create.l HWIO_QDSP_XPU_PRT8_CNTL1_QDSP_ADDR A:0x6003665c
y.create.l HWIO_QDSP_XPU_PRT9_CNTL1_QDSP_ADDR A:0x600366dc
y.create.l HWIO_IPA_SMMU_XPU_SCR_IPA_SMMU_ADDR A:0x60037000
y.create.l HWIO_IPA_SMMU_XPU_SWDR_IPA_SMMU_ADDR A:0x60037004
y.create.l HWIO_IPA_SMMU_XPU_PRTN_RACR_SSHADOW_IPA_SMMU_ADDR A:0x60037008
y.create.l HWIO_IPA_SMMU_XPU_PRTN_START_SSHADOW0_IPA_SMMU_ADDR A:0x60037010
y.create.l HWIO_IPA_SMMU_XPU_PRTN_END_SSHADOW0_IPA_SMMU_ADDR A:0x60037018
y.create.l HWIO_IPA_SMMU_XPU_SEAR0_IPA_SMMU_ADDR A:0x60037040
y.create.l HWIO_IPA_SMMU_XPU_SESR_IPA_SMMU_ADDR A:0x60037048
y.create.l HWIO_IPA_SMMU_XPU_SESRRESTORE_IPA_SMMU_ADDR A:0x6003704c
y.create.l HWIO_IPA_SMMU_XPU_SESYNR0_IPA_SMMU_ADDR A:0x60037050
y.create.l HWIO_IPA_SMMU_XPU_SESYNR1_IPA_SMMU_ADDR A:0x60037054
y.create.l HWIO_IPA_SMMU_XPU_SESYNR2_IPA_SMMU_ADDR A:0x60037058
y.create.l HWIO_IPA_SMMU_XPU_MCR_IPA_SMMU_ADDR A:0x60037100
y.create.l HWIO_IPA_SMMU_XPU_MEAR0_IPA_SMMU_ADDR A:0x60037140
y.create.l HWIO_IPA_SMMU_XPU_MESR_IPA_SMMU_ADDR A:0x60037148
y.create.l HWIO_IPA_SMMU_XPU_MESRRESTORE_IPA_SMMU_ADDR A:0x6003714c
y.create.l HWIO_IPA_SMMU_XPU_MESYNR0_IPA_SMMU_ADDR A:0x60037150
y.create.l HWIO_IPA_SMMU_XPU_MESYNR1_IPA_SMMU_ADDR A:0x60037154
y.create.l HWIO_IPA_SMMU_XPU_MESYNR2_IPA_SMMU_ADDR A:0x60037158
y.create.l HWIO_IPA_SMMU_XPU_CR_IPA_SMMU_ADDR A:0x60037080
y.create.l HWIO_IPA_SMMU_XPU_PRTN_RACR_SHADOW_IPA_SMMU_ADDR A:0x60037088
y.create.l HWIO_IPA_SMMU_XPU_PRTN_START_SHADOW0_IPA_SMMU_ADDR A:0x60037090
y.create.l HWIO_IPA_SMMU_XPU_PRTN_END_SHADOW0_IPA_SMMU_ADDR A:0x60037098
y.create.l HWIO_IPA_SMMU_XPU_RPU_ACR0_IPA_SMMU_ADDR A:0x600370a0
y.create.l HWIO_IPA_SMMU_XPU_EAR0_IPA_SMMU_ADDR A:0x600370c0
y.create.l HWIO_IPA_SMMU_XPU_ESR_IPA_SMMU_ADDR A:0x600370c8
y.create.l HWIO_IPA_SMMU_XPU_ESRRESTORE_IPA_SMMU_ADDR A:0x600370cc
y.create.l HWIO_IPA_SMMU_XPU_ESYNR0_IPA_SMMU_ADDR A:0x600370d0
y.create.l HWIO_IPA_SMMU_XPU_ESYNR1_IPA_SMMU_ADDR A:0x600370d4
y.create.l HWIO_IPA_SMMU_XPU_ESYNR2_IPA_SMMU_ADDR A:0x600370d8
y.create.l HWIO_IPA_SMMU_XPU_UMR_RACR_IPA_SMMU_ADDR A:0x600370e0
y.create.l HWIO_IPA_SMMU_XPU_UMR_WACR_IPA_SMMU_ADDR A:0x600370e4
y.create.l HWIO_IPA_SMMU_XPU_UMR_CNTL_IPA_SMMU_ADDR A:0x600370f0
y.create.l HWIO_IPA_SMMU_XPU_IDR0_IPA_SMMU_ADDR A:0x60037074
y.create.l HWIO_IPA_SMMU_XPU_IDR1_IPA_SMMU_ADDR A:0x60037078
y.create.l HWIO_IPA_SMMU_XPU_REV_IPA_SMMU_ADDR A:0x6003707c
y.create.l HWIO_IPA_SMMU_XPU_PRT0_RACR0_IPA_SMMU_ADDR A:0x60037200
y.create.l HWIO_IPA_SMMU_XPU_PRT1_RACR0_IPA_SMMU_ADDR A:0x60037280
y.create.l HWIO_IPA_SMMU_XPU_PRT2_RACR0_IPA_SMMU_ADDR A:0x60037300
y.create.l HWIO_IPA_SMMU_XPU_PRT3_RACR0_IPA_SMMU_ADDR A:0x60037380
y.create.l HWIO_IPA_SMMU_XPU_PRT4_RACR0_IPA_SMMU_ADDR A:0x60037400
y.create.l HWIO_IPA_SMMU_XPU_PRT5_RACR0_IPA_SMMU_ADDR A:0x60037480
y.create.l HWIO_IPA_SMMU_XPU_PRT6_RACR0_IPA_SMMU_ADDR A:0x60037500
y.create.l HWIO_IPA_SMMU_XPU_PRT7_RACR0_IPA_SMMU_ADDR A:0x60037580
y.create.l HWIO_IPA_SMMU_XPU_PRT8_RACR0_IPA_SMMU_ADDR A:0x60037600
y.create.l HWIO_IPA_SMMU_XPU_PRT9_RACR0_IPA_SMMU_ADDR A:0x60037680
y.create.l HWIO_IPA_SMMU_XPU_PRT0_START0_IPA_SMMU_ADDR A:0x60037240
y.create.l HWIO_IPA_SMMU_XPU_PRT1_START0_IPA_SMMU_ADDR A:0x600372c0
y.create.l HWIO_IPA_SMMU_XPU_PRT2_START0_IPA_SMMU_ADDR A:0x60037340
y.create.l HWIO_IPA_SMMU_XPU_PRT3_START0_IPA_SMMU_ADDR A:0x600373c0
y.create.l HWIO_IPA_SMMU_XPU_PRT4_START0_IPA_SMMU_ADDR A:0x60037440
y.create.l HWIO_IPA_SMMU_XPU_PRT5_START0_IPA_SMMU_ADDR A:0x600374c0
y.create.l HWIO_IPA_SMMU_XPU_PRT6_START0_IPA_SMMU_ADDR A:0x60037540
y.create.l HWIO_IPA_SMMU_XPU_PRT7_START0_IPA_SMMU_ADDR A:0x600375c0
y.create.l HWIO_IPA_SMMU_XPU_PRT8_START0_IPA_SMMU_ADDR A:0x60037640
y.create.l HWIO_IPA_SMMU_XPU_PRT9_START0_IPA_SMMU_ADDR A:0x600376c0
y.create.l HWIO_IPA_SMMU_XPU_PRT0_END0_IPA_SMMU_ADDR A:0x60037248
y.create.l HWIO_IPA_SMMU_XPU_PRT1_END0_IPA_SMMU_ADDR A:0x600372c8
y.create.l HWIO_IPA_SMMU_XPU_PRT2_END0_IPA_SMMU_ADDR A:0x60037348
y.create.l HWIO_IPA_SMMU_XPU_PRT3_END0_IPA_SMMU_ADDR A:0x600373c8
y.create.l HWIO_IPA_SMMU_XPU_PRT4_END0_IPA_SMMU_ADDR A:0x60037448
y.create.l HWIO_IPA_SMMU_XPU_PRT5_END0_IPA_SMMU_ADDR A:0x600374c8
y.create.l HWIO_IPA_SMMU_XPU_PRT6_END0_IPA_SMMU_ADDR A:0x60037548
y.create.l HWIO_IPA_SMMU_XPU_PRT7_END0_IPA_SMMU_ADDR A:0x600375c8
y.create.l HWIO_IPA_SMMU_XPU_PRT8_END0_IPA_SMMU_ADDR A:0x60037648
y.create.l HWIO_IPA_SMMU_XPU_PRT9_END0_IPA_SMMU_ADDR A:0x600376c8
y.create.l HWIO_IPA_SMMU_XPU_PRT0_SCR_IPA_SMMU_ADDR A:0x60037250
y.create.l HWIO_IPA_SMMU_XPU_PRT1_SCR_IPA_SMMU_ADDR A:0x600372d0
y.create.l HWIO_IPA_SMMU_XPU_PRT2_SCR_IPA_SMMU_ADDR A:0x60037350
y.create.l HWIO_IPA_SMMU_XPU_PRT3_SCR_IPA_SMMU_ADDR A:0x600373d0
y.create.l HWIO_IPA_SMMU_XPU_PRT4_SCR_IPA_SMMU_ADDR A:0x60037450
y.create.l HWIO_IPA_SMMU_XPU_PRT5_SCR_IPA_SMMU_ADDR A:0x600374d0
y.create.l HWIO_IPA_SMMU_XPU_PRT6_SCR_IPA_SMMU_ADDR A:0x60037550
y.create.l HWIO_IPA_SMMU_XPU_PRT7_SCR_IPA_SMMU_ADDR A:0x600375d0
y.create.l HWIO_IPA_SMMU_XPU_PRT8_SCR_IPA_SMMU_ADDR A:0x60037650
y.create.l HWIO_IPA_SMMU_XPU_PRT9_SCR_IPA_SMMU_ADDR A:0x600376d0
y.create.l HWIO_IPA_SMMU_XPU_PRT0_MCR_IPA_SMMU_ADDR A:0x60037254
y.create.l HWIO_IPA_SMMU_XPU_PRT1_MCR_IPA_SMMU_ADDR A:0x600372d4
y.create.l HWIO_IPA_SMMU_XPU_PRT2_MCR_IPA_SMMU_ADDR A:0x60037354
y.create.l HWIO_IPA_SMMU_XPU_PRT3_MCR_IPA_SMMU_ADDR A:0x600373d4
y.create.l HWIO_IPA_SMMU_XPU_PRT4_MCR_IPA_SMMU_ADDR A:0x60037454
y.create.l HWIO_IPA_SMMU_XPU_PRT5_MCR_IPA_SMMU_ADDR A:0x600374d4
y.create.l HWIO_IPA_SMMU_XPU_PRT6_MCR_IPA_SMMU_ADDR A:0x60037554
y.create.l HWIO_IPA_SMMU_XPU_PRT7_MCR_IPA_SMMU_ADDR A:0x600375d4
y.create.l HWIO_IPA_SMMU_XPU_PRT8_MCR_IPA_SMMU_ADDR A:0x60037654
y.create.l HWIO_IPA_SMMU_XPU_PRT9_MCR_IPA_SMMU_ADDR A:0x600376d4
y.create.l HWIO_IPA_SMMU_XPU_PRT0_CNTL0_IPA_SMMU_ADDR A:0x60037258
y.create.l HWIO_IPA_SMMU_XPU_PRT1_CNTL0_IPA_SMMU_ADDR A:0x600372d8
y.create.l HWIO_IPA_SMMU_XPU_PRT2_CNTL0_IPA_SMMU_ADDR A:0x60037358
y.create.l HWIO_IPA_SMMU_XPU_PRT3_CNTL0_IPA_SMMU_ADDR A:0x600373d8
y.create.l HWIO_IPA_SMMU_XPU_PRT4_CNTL0_IPA_SMMU_ADDR A:0x60037458
y.create.l HWIO_IPA_SMMU_XPU_PRT5_CNTL0_IPA_SMMU_ADDR A:0x600374d8
y.create.l HWIO_IPA_SMMU_XPU_PRT6_CNTL0_IPA_SMMU_ADDR A:0x60037558
y.create.l HWIO_IPA_SMMU_XPU_PRT7_CNTL0_IPA_SMMU_ADDR A:0x600375d8
y.create.l HWIO_IPA_SMMU_XPU_PRT8_CNTL0_IPA_SMMU_ADDR A:0x60037658
y.create.l HWIO_IPA_SMMU_XPU_PRT9_CNTL0_IPA_SMMU_ADDR A:0x600376d8
y.create.l HWIO_IPA_SMMU_XPU_PRT0_CNTL1_IPA_SMMU_ADDR A:0x6003725c
y.create.l HWIO_IPA_SMMU_XPU_PRT1_CNTL1_IPA_SMMU_ADDR A:0x600372dc
y.create.l HWIO_IPA_SMMU_XPU_PRT2_CNTL1_IPA_SMMU_ADDR A:0x6003735c
y.create.l HWIO_IPA_SMMU_XPU_PRT3_CNTL1_IPA_SMMU_ADDR A:0x600373dc
y.create.l HWIO_IPA_SMMU_XPU_PRT4_CNTL1_IPA_SMMU_ADDR A:0x6003745c
y.create.l HWIO_IPA_SMMU_XPU_PRT5_CNTL1_IPA_SMMU_ADDR A:0x600374dc
y.create.l HWIO_IPA_SMMU_XPU_PRT6_CNTL1_IPA_SMMU_ADDR A:0x6003755c
y.create.l HWIO_IPA_SMMU_XPU_PRT7_CNTL1_IPA_SMMU_ADDR A:0x600375dc
y.create.l HWIO_IPA_SMMU_XPU_PRT8_CNTL1_IPA_SMMU_ADDR A:0x6003765c
y.create.l HWIO_IPA_SMMU_XPU_PRT9_CNTL1_IPA_SMMU_ADDR A:0x600376dc
y.create.l HWIO_CE_XPU_SCR_CE_ADDR A:0x60038000
y.create.l HWIO_CE_XPU_SWDR_CE_ADDR A:0x60038004
y.create.l HWIO_CE_XPU_PRTN_RACR_SSHADOW_CE_ADDR A:0x60038008
y.create.l HWIO_CE_XPU_PRTN_START_SSHADOW0_CE_ADDR A:0x60038010
y.create.l HWIO_CE_XPU_PRTN_END_SSHADOW0_CE_ADDR A:0x60038018
y.create.l HWIO_CE_XPU_SEAR0_CE_ADDR A:0x60038040
y.create.l HWIO_CE_XPU_SESR_CE_ADDR A:0x60038048
y.create.l HWIO_CE_XPU_SESRRESTORE_CE_ADDR A:0x6003804c
y.create.l HWIO_CE_XPU_SESYNR0_CE_ADDR A:0x60038050
y.create.l HWIO_CE_XPU_SESYNR1_CE_ADDR A:0x60038054
y.create.l HWIO_CE_XPU_SESYNR2_CE_ADDR A:0x60038058
y.create.l HWIO_CE_XPU_MCR_CE_ADDR A:0x60038100
y.create.l HWIO_CE_XPU_MEAR0_CE_ADDR A:0x60038140
y.create.l HWIO_CE_XPU_MESR_CE_ADDR A:0x60038148
y.create.l HWIO_CE_XPU_MESRRESTORE_CE_ADDR A:0x6003814c
y.create.l HWIO_CE_XPU_MESYNR0_CE_ADDR A:0x60038150
y.create.l HWIO_CE_XPU_MESYNR1_CE_ADDR A:0x60038154
y.create.l HWIO_CE_XPU_MESYNR2_CE_ADDR A:0x60038158
y.create.l HWIO_CE_XPU_CR_CE_ADDR A:0x60038080
y.create.l HWIO_CE_XPU_PRTN_RACR_SHADOW_CE_ADDR A:0x60038088
y.create.l HWIO_CE_XPU_PRTN_START_SHADOW0_CE_ADDR A:0x60038090
y.create.l HWIO_CE_XPU_PRTN_END_SHADOW0_CE_ADDR A:0x60038098
y.create.l HWIO_CE_XPU_RPU_ACR0_CE_ADDR A:0x600380a0
y.create.l HWIO_CE_XPU_EAR0_CE_ADDR A:0x600380c0
y.create.l HWIO_CE_XPU_ESR_CE_ADDR A:0x600380c8
y.create.l HWIO_CE_XPU_ESRRESTORE_CE_ADDR A:0x600380cc
y.create.l HWIO_CE_XPU_ESYNR0_CE_ADDR A:0x600380d0
y.create.l HWIO_CE_XPU_ESYNR1_CE_ADDR A:0x600380d4
y.create.l HWIO_CE_XPU_ESYNR2_CE_ADDR A:0x600380d8
y.create.l HWIO_CE_XPU_UMR_RACR_CE_ADDR A:0x600380e0
y.create.l HWIO_CE_XPU_UMR_WACR_CE_ADDR A:0x600380e4
y.create.l HWIO_CE_XPU_UMR_CNTL_CE_ADDR A:0x600380f0
y.create.l HWIO_CE_XPU_IDR0_CE_ADDR A:0x60038074
y.create.l HWIO_CE_XPU_IDR1_CE_ADDR A:0x60038078
y.create.l HWIO_CE_XPU_REV_CE_ADDR A:0x6003807c
y.create.l HWIO_CE_XPU_PRT0_RACR0_CE_ADDR A:0x60038200
y.create.l HWIO_CE_XPU_PRT1_RACR0_CE_ADDR A:0x60038280
y.create.l HWIO_CE_XPU_PRT2_RACR0_CE_ADDR A:0x60038300
y.create.l HWIO_CE_XPU_PRT3_RACR0_CE_ADDR A:0x60038380
y.create.l HWIO_CE_XPU_PRT4_RACR0_CE_ADDR A:0x60038400
y.create.l HWIO_CE_XPU_PRT5_RACR0_CE_ADDR A:0x60038480
y.create.l HWIO_CE_XPU_PRT6_RACR0_CE_ADDR A:0x60038500
y.create.l HWIO_CE_XPU_PRT7_RACR0_CE_ADDR A:0x60038580
y.create.l HWIO_CE_XPU_PRT8_RACR0_CE_ADDR A:0x60038600
y.create.l HWIO_CE_XPU_PRT9_RACR0_CE_ADDR A:0x60038680
y.create.l HWIO_CE_XPU_PRT0_START0_CE_ADDR A:0x60038240
y.create.l HWIO_CE_XPU_PRT1_START0_CE_ADDR A:0x600382c0
y.create.l HWIO_CE_XPU_PRT2_START0_CE_ADDR A:0x60038340
y.create.l HWIO_CE_XPU_PRT3_START0_CE_ADDR A:0x600383c0
y.create.l HWIO_CE_XPU_PRT4_START0_CE_ADDR A:0x60038440
y.create.l HWIO_CE_XPU_PRT5_START0_CE_ADDR A:0x600384c0
y.create.l HWIO_CE_XPU_PRT6_START0_CE_ADDR A:0x60038540
y.create.l HWIO_CE_XPU_PRT7_START0_CE_ADDR A:0x600385c0
y.create.l HWIO_CE_XPU_PRT8_START0_CE_ADDR A:0x60038640
y.create.l HWIO_CE_XPU_PRT9_START0_CE_ADDR A:0x600386c0
y.create.l HWIO_CE_XPU_PRT0_END0_CE_ADDR A:0x60038248
y.create.l HWIO_CE_XPU_PRT1_END0_CE_ADDR A:0x600382c8
y.create.l HWIO_CE_XPU_PRT2_END0_CE_ADDR A:0x60038348
y.create.l HWIO_CE_XPU_PRT3_END0_CE_ADDR A:0x600383c8
y.create.l HWIO_CE_XPU_PRT4_END0_CE_ADDR A:0x60038448
y.create.l HWIO_CE_XPU_PRT5_END0_CE_ADDR A:0x600384c8
y.create.l HWIO_CE_XPU_PRT6_END0_CE_ADDR A:0x60038548
y.create.l HWIO_CE_XPU_PRT7_END0_CE_ADDR A:0x600385c8
y.create.l HWIO_CE_XPU_PRT8_END0_CE_ADDR A:0x60038648
y.create.l HWIO_CE_XPU_PRT9_END0_CE_ADDR A:0x600386c8
y.create.l HWIO_CE_XPU_PRT0_SCR_CE_ADDR A:0x60038250
y.create.l HWIO_CE_XPU_PRT1_SCR_CE_ADDR A:0x600382d0
y.create.l HWIO_CE_XPU_PRT2_SCR_CE_ADDR A:0x60038350
y.create.l HWIO_CE_XPU_PRT3_SCR_CE_ADDR A:0x600383d0
y.create.l HWIO_CE_XPU_PRT4_SCR_CE_ADDR A:0x60038450
y.create.l HWIO_CE_XPU_PRT5_SCR_CE_ADDR A:0x600384d0
y.create.l HWIO_CE_XPU_PRT6_SCR_CE_ADDR A:0x60038550
y.create.l HWIO_CE_XPU_PRT7_SCR_CE_ADDR A:0x600385d0
y.create.l HWIO_CE_XPU_PRT8_SCR_CE_ADDR A:0x60038650
y.create.l HWIO_CE_XPU_PRT9_SCR_CE_ADDR A:0x600386d0
y.create.l HWIO_CE_XPU_PRT0_MCR_CE_ADDR A:0x60038254
y.create.l HWIO_CE_XPU_PRT1_MCR_CE_ADDR A:0x600382d4
y.create.l HWIO_CE_XPU_PRT2_MCR_CE_ADDR A:0x60038354
y.create.l HWIO_CE_XPU_PRT3_MCR_CE_ADDR A:0x600383d4
y.create.l HWIO_CE_XPU_PRT4_MCR_CE_ADDR A:0x60038454
y.create.l HWIO_CE_XPU_PRT5_MCR_CE_ADDR A:0x600384d4
y.create.l HWIO_CE_XPU_PRT6_MCR_CE_ADDR A:0x60038554
y.create.l HWIO_CE_XPU_PRT7_MCR_CE_ADDR A:0x600385d4
y.create.l HWIO_CE_XPU_PRT8_MCR_CE_ADDR A:0x60038654
y.create.l HWIO_CE_XPU_PRT9_MCR_CE_ADDR A:0x600386d4
y.create.l HWIO_CE_XPU_PRT0_CNTL0_CE_ADDR A:0x60038258
y.create.l HWIO_CE_XPU_PRT1_CNTL0_CE_ADDR A:0x600382d8
y.create.l HWIO_CE_XPU_PRT2_CNTL0_CE_ADDR A:0x60038358
y.create.l HWIO_CE_XPU_PRT3_CNTL0_CE_ADDR A:0x600383d8
y.create.l HWIO_CE_XPU_PRT4_CNTL0_CE_ADDR A:0x60038458
y.create.l HWIO_CE_XPU_PRT5_CNTL0_CE_ADDR A:0x600384d8
y.create.l HWIO_CE_XPU_PRT6_CNTL0_CE_ADDR A:0x60038558
y.create.l HWIO_CE_XPU_PRT7_CNTL0_CE_ADDR A:0x600385d8
y.create.l HWIO_CE_XPU_PRT8_CNTL0_CE_ADDR A:0x60038658
y.create.l HWIO_CE_XPU_PRT9_CNTL0_CE_ADDR A:0x600386d8
y.create.l HWIO_CE_XPU_PRT0_CNTL1_CE_ADDR A:0x6003825c
y.create.l HWIO_CE_XPU_PRT1_CNTL1_CE_ADDR A:0x600382dc
y.create.l HWIO_CE_XPU_PRT2_CNTL1_CE_ADDR A:0x6003835c
y.create.l HWIO_CE_XPU_PRT3_CNTL1_CE_ADDR A:0x600383dc
y.create.l HWIO_CE_XPU_PRT4_CNTL1_CE_ADDR A:0x6003845c
y.create.l HWIO_CE_XPU_PRT5_CNTL1_CE_ADDR A:0x600384dc
y.create.l HWIO_CE_XPU_PRT6_CNTL1_CE_ADDR A:0x6003855c
y.create.l HWIO_CE_XPU_PRT7_CNTL1_CE_ADDR A:0x600385dc
y.create.l HWIO_CE_XPU_PRT8_CNTL1_CE_ADDR A:0x6003865c
y.create.l HWIO_CE_XPU_PRT9_CNTL1_CE_ADDR A:0x600386dc
y.create.l HWIO_SNOC_0_ABT_HW_VERSION_ADDR A:0x68801000
y.create.l HWIO_SNOC_0_ABT_INST_ID_ADDR A:0x68801004
y.create.l HWIO_SNOC_0_ABT_NUM_SLAVES_ADDR A:0x68801008
y.create.l HWIO_SNOC_0_ABT_TIMER_LOADVAL_ADDR A:0x6880100c
y.create.l HWIO_SNOC_0_ABT_TIMER_MODE_ADDR A:0x68801010
y.create.l HWIO_SNOC_0_ABT_INTR_STATUS_ADDR A:0x68801014
y.create.l HWIO_SNOC_0_ABT_INTR_CLEAR_ADDR A:0x68801018
y.create.l HWIO_SNOC_0_ABT_INTR_ENABLE_ADDR A:0x6880101c
y.create.l HWIO_SNOC_0_ABT_SYND_VALID_ADDR A:0x68801020
y.create.l HWIO_SNOC_0_ABT_SYND_CLEAR_ADDR A:0x68801024
y.create.l HWIO_SNOC_0_ABT_SYND_ID_ADDR A:0x68801028
y.create.l HWIO_SNOC_0_ABT_SYND_ADDR0_ADDR A:0x6880102c
y.create.l HWIO_SNOC_0_ABT_SYND_ADDR1_ADDR A:0x68801030
y.create.l HWIO_SNOC_0_ABT_SYND_HREADY_ADDR A:0x68801034
y.create.l HWIO_SNOC_2_ABT_HW_VERSION_ADDR A:0x68802000
y.create.l HWIO_SNOC_2_ABT_INST_ID_ADDR A:0x68802004
y.create.l HWIO_SNOC_2_ABT_NUM_SLAVES_ADDR A:0x68802008
y.create.l HWIO_SNOC_2_ABT_TIMER_LOADVAL_ADDR A:0x6880200c
y.create.l HWIO_SNOC_2_ABT_TIMER_MODE_ADDR A:0x68802010
y.create.l HWIO_SNOC_2_ABT_INTR_STATUS_ADDR A:0x68802014
y.create.l HWIO_SNOC_2_ABT_INTR_CLEAR_ADDR A:0x68802018
y.create.l HWIO_SNOC_2_ABT_INTR_ENABLE_ADDR A:0x6880201c
y.create.l HWIO_SNOC_2_ABT_SYND_VALID_ADDR A:0x68802020
y.create.l HWIO_SNOC_2_ABT_SYND_CLEAR_ADDR A:0x68802024
y.create.l HWIO_SNOC_2_ABT_SYND_ID_ADDR A:0x68802028
y.create.l HWIO_SNOC_2_ABT_SYND_ADDR0_ADDR A:0x6880202c
y.create.l HWIO_SNOC_2_ABT_SYND_ADDR1_ADDR A:0x68802030
y.create.l HWIO_SNOC_2_ABT_SYND_HREADY_ADDR A:0x68802034
y.create.l HWIO_SPDM_CREG_CFG0_ADDR A:0x60040000
y.create.l HWIO_SPDM_CREG_HW_INFO_ADDR A:0x60040004
y.create.l HWIO_SPDM_CREG_HW_VERSION_ADDR A:0x60040008
y.create.l HWIO_SPDM_CREG_MUTEX_0_ADDR A:0x60040100
y.create.l HWIO_SPDM_OLEM_CFG0_ADDR A:0x60041000
y.create.l HWIO_SPDM_OLEM_CFG1_ADDR A:0x60041004
y.create.l HWIO_SPDM_OLEM_CFG2_ADDR A:0x60041008
y.create.l HWIO_SPDM_OLEM_CFG3_ADDR A:0x6004100c
y.create.l HWIO_SPDM_OLEM_CFG4_ADDR A:0x60041010
y.create.l HWIO_SPDM_OLEM_CFG5_ADDR A:0x60041014
y.create.l HWIO_SPDM_OLEM_CFG6_ADDR A:0x60041018
y.create.l HWIO_SPDM_OLEM_CYCLE_C0_OUT_ADDR A:0x60041020
y.create.l HWIO_SPDM_OLEM_CYCLE_C1_OUT_ADDR A:0x60041024
y.create.l HWIO_SPDM_OLEM_CYCLE_C2_OUT_ADDR A:0x60041028
y.create.l HWIO_SPDM_OLEM_CYCLE_C3_OUT_ADDR A:0x6004102c
y.create.l HWIO_SPDM_OLEM_CYCLE_C4_OUT_ADDR A:0x60041030
y.create.l HWIO_SPDM_OLEM_CYCLE_C5_OUT_ADDR A:0x60041034
y.create.l HWIO_SPDM_OLEM_CYCLE_C6_OUT_ADDR A:0x60041038
y.create.l HWIO_SPDM_OLEM_CYCLE_C7_OUT_ADDR A:0x6004103c
y.create.l HWIO_SPDM_OLEM_CYCLE_C8_OUT_ADDR A:0x60041040
y.create.l HWIO_SPDM_OLEM_CYCLE_C9_OUT_ADDR A:0x60041044
y.create.l HWIO_SPDM_OLEM_EVENT_C0_OUT_ADDR A:0x600410a0
y.create.l HWIO_SPDM_OLEM_EVENT_C1_OUT_ADDR A:0x600410a4
y.create.l HWIO_SPDM_OLEM_EVENT_C2_OUT_ADDR A:0x600410a8
y.create.l HWIO_SPDM_OLEM_EVENT_C3_OUT_ADDR A:0x600410ac
y.create.l HWIO_SPDM_OLEM_EVENT_C4_OUT_ADDR A:0x600410b0
y.create.l HWIO_SPDM_OLEM_EVENT_C5_OUT_ADDR A:0x600410b4
y.create.l HWIO_SPDM_OLEM_EVENT_C6_OUT_ADDR A:0x600410b8
y.create.l HWIO_SPDM_OLEM_EVENT_C7_OUT_ADDR A:0x600410bc
y.create.l HWIO_SPDM_OLEM_EVENT_C8_OUT_ADDR A:0x600410c0
y.create.l HWIO_SPDM_OLEM_EVENT_C9_OUT_ADDR A:0x600410c4
y.create.l HWIO_SPDM_OLEM_MULTIBIT_C0_OUT_ADDR A:0x60041120
y.create.l HWIO_SPDM_OLEM_MULTIBIT_C1_OUT_ADDR A:0x60041124
y.create.l HWIO_SPDM_OLEM_MULTIBIT_C2_OUT_ADDR A:0x60041128
y.create.l HWIO_SPDM_OLEM_MULTIBIT_C3_OUT_ADDR A:0x6004112c
y.create.l HWIO_SPDM_OLEM_MULTIBIT_C4_OUT_ADDR A:0x60041130
y.create.l HWIO_SPDM_OLEM_MULTIBIT_C5_OUT_ADDR A:0x60041134
y.create.l HWIO_SPDM_OLEM_MULTIBIT_C6_OUT_ADDR A:0x60041138
y.create.l HWIO_SPDM_OLEM_MULTIBIT_C7_OUT_ADDR A:0x6004113c
y.create.l HWIO_SPDM_RT_LOW_THRESH_STATUS_ADDR A:0x60042000
y.create.l HWIO_SPDM_RT_HIGH_THRESH_STATUS_ADDR A:0x60042004
y.create.l HWIO_SPDM_RT_LOW_IRQ_EN_0_ADDR A:0x60042010
y.create.l HWIO_SPDM_RT_LOW_IRQ_EN_1_ADDR A:0x60042014
y.create.l HWIO_SPDM_RT_LOW_IRQ_EN_2_ADDR A:0x60042018
y.create.l HWIO_SPDM_RT_LOW_IRQ_EN_3_ADDR A:0x6004201c
y.create.l HWIO_SPDM_RT_HIGH_IRQ_EN_0_ADDR A:0x60042020
y.create.l HWIO_SPDM_RT_HIGH_IRQ_EN_1_ADDR A:0x60042024
y.create.l HWIO_SPDM_RT_HIGH_IRQ_EN_2_ADDR A:0x60042028
y.create.l HWIO_SPDM_RT_HIGH_IRQ_EN_3_ADDR A:0x6004202c
y.create.l HWIO_SPDM_RT_IRQ_TIMER_0_ADDR A:0x60042030
y.create.l HWIO_SPDM_RT_IRQ_TIMER_1_ADDR A:0x60042034
y.create.l HWIO_SPDM_RT_IRQ_TIMER_2_ADDR A:0x60042038
y.create.l HWIO_SPDM_RT_IRQ_TIMER_3_ADDR A:0x6004203c
y.create.l HWIO_SPDM_RT_DIAG_MUX_SEL_ADDR A:0x60042040
y.create.l HWIO_SPDM_RT_MON_EN_ADDR A:0x60042050
y.create.l HWIO_SPDM_RT_MON_EN_SET_ADDR A:0x60042054
y.create.l HWIO_SPDM_RT_MON_EN_CLEAR_ADDR A:0x60042058
y.create.l HWIO_SPDM_RT_MON_RST_ADDR A:0x60042060
y.create.l HWIO_SPDM_RT_MON_RST_SET_ADDR A:0x60042064
y.create.l HWIO_SPDM_RT_MON_RST_CLEAR_ADDR A:0x60042068
y.create.l HWIO_SPDM_RT_MON_CFG_0_ADDR A:0x60042100
y.create.l HWIO_SPDM_RT_MON_CFG_1_ADDR A:0x60042110
y.create.l HWIO_SPDM_RT_MON_CFG_2_ADDR A:0x60042120
y.create.l HWIO_SPDM_RT_MON_CFG_3_ADDR A:0x60042130
y.create.l HWIO_SPDM_RT_MON_CFG_4_ADDR A:0x60042140
y.create.l HWIO_SPDM_RT_MON_CFG_5_ADDR A:0x60042150
y.create.l HWIO_SPDM_RT_MON_CFG_6_ADDR A:0x60042160
y.create.l HWIO_SPDM_RT_MON_CFG_7_ADDR A:0x60042170
y.create.l HWIO_SPDM_RT_MON_CFG_8_ADDR A:0x60042180
y.create.l HWIO_SPDM_RT_MON_CFG_9_ADDR A:0x60042190
y.create.l HWIO_SPDM_RT_THRESH_CFG_0_ADDR A:0x60042104
y.create.l HWIO_SPDM_RT_THRESH_CFG_1_ADDR A:0x60042114
y.create.l HWIO_SPDM_RT_THRESH_CFG_2_ADDR A:0x60042124
y.create.l HWIO_SPDM_RT_THRESH_CFG_3_ADDR A:0x60042134
y.create.l HWIO_SPDM_RT_THRESH_CFG_4_ADDR A:0x60042144
y.create.l HWIO_SPDM_RT_THRESH_CFG_5_ADDR A:0x60042154
y.create.l HWIO_SPDM_RT_THRESH_CFG_6_ADDR A:0x60042164
y.create.l HWIO_SPDM_RT_THRESH_CFG_7_ADDR A:0x60042174
y.create.l HWIO_SPDM_RT_THRESH_CFG_8_ADDR A:0x60042184
y.create.l HWIO_SPDM_RT_THRESH_CFG_9_ADDR A:0x60042194
y.create.l HWIO_SPDM_RT_MON_STATUS_0_ADDR A:0x60042108
y.create.l HWIO_SPDM_RT_MON_STATUS_1_ADDR A:0x60042118
y.create.l HWIO_SPDM_RT_MON_STATUS_2_ADDR A:0x60042128
y.create.l HWIO_SPDM_RT_MON_STATUS_3_ADDR A:0x60042138
y.create.l HWIO_SPDM_RT_MON_STATUS_4_ADDR A:0x60042148
y.create.l HWIO_SPDM_RT_MON_STATUS_5_ADDR A:0x60042158
y.create.l HWIO_SPDM_RT_MON_STATUS_6_ADDR A:0x60042168
y.create.l HWIO_SPDM_RT_MON_STATUS_7_ADDR A:0x60042178
y.create.l HWIO_SPDM_RT_MON_STATUS_8_ADDR A:0x60042188
y.create.l HWIO_SPDM_RT_MON_STATUS_9_ADDR A:0x60042198
y.create.l HWIO_SPDM_SREG_CFG0_ADDR A:0x60044000
y.create.l HWIO_SPDM_SREG_CFG1_ADDR A:0x60044004
y.create.l HWIO_SPDM_SREG_MUTEX_0_ADDR A:0x60044100
y.create.l HWIO_SNOC_OBS_ID_COREID_ADDR A:0x60580000
y.create.l HWIO_SNOC_OBS_ID_REVISIONID_ADDR A:0x60580004
y.create.l HWIO_SNOC_OBS_FAULTEN_ADDR A:0x60580008
y.create.l HWIO_SNOC_OBS_ERRVLD_ADDR A:0x6058000c
y.create.l HWIO_SNOC_OBS_ERRCLR_ADDR A:0x60580010
y.create.l HWIO_SNOC_OBS_ERRLOG0_ADDR A:0x60580014
y.create.l HWIO_SNOC_OBS_ERRLOG1_ADDR A:0x60580018
y.create.l HWIO_SNOC_OBS_ERRLOG3_ADDR A:0x60580020
y.create.l HWIO_SNOC_OBS_ERRLOG4_ADDR A:0x60580024
y.create.l HWIO_SNOC_OBS_ERRLOG5_ADDR A:0x60580028
y.create.l HWIO_SNOC_OBS_DBG_ID_COREID_ADDR A:0x60580080
y.create.l HWIO_SNOC_OBS_DBG_ID_REVISIONID_ADDR A:0x60580084
y.create.l HWIO_SNOC_OBS_DBG_ATBID_ADDR A:0x60580088
y.create.l HWIO_SNOC_OBS_DBG_ATBEN_ADDR A:0x6058008c
y.create.l HWIO_SNOC_OBS_DBG_SYNCPERIOD_ADDR A:0x60580090
y.create.l HWIO_SNOC_MSS_CRYPTO_NAV_DBG_TFILT_ID_COREID_ADDR A:0x60581080
y.create.l HWIO_SNOC_MSS_CRYPTO_NAV_DBG_TFILT_ID_REVISIONID_ADDR A:0x60581084
y.create.l HWIO_SNOC_MSS_CRYPTO_NAV_DBG_TFILT_MODE_ADDR A:0x60581088
y.create.l HWIO_SNOC_MSS_CRYPTO_NAV_DBG_TFILT_ADDRBASE_LOW_ADDR A:0x6058108c
y.create.l HWIO_SNOC_MSS_CRYPTO_NAV_DBG_TFILT_ADDRBASE_HIGH_ADDR A:0x60581090
y.create.l HWIO_SNOC_MSS_CRYPTO_NAV_DBG_TFILT_ADDRWINDOWSIZE_ADDR A:0x60581094
y.create.l HWIO_SNOC_MSS_CRYPTO_NAV_DBG_TFILT_SRCIDBASE_ADDR A:0x60581098
y.create.l HWIO_SNOC_MSS_CRYPTO_NAV_DBG_TFILT_SRCIDMASK_ADDR A:0x6058109c
y.create.l HWIO_SNOC_MSS_CRYPTO_NAV_DBG_TFILT_OPCODE_ADDR A:0x605810a0
y.create.l HWIO_SNOC_MSS_CRYPTO_NAV_DBG_TFILT_USERBASE_ADDR A:0x605810a4
y.create.l HWIO_SNOC_MSS_CRYPTO_NAV_DBG_TFILT_USERMASK_ADDR A:0x605810a8
y.create.l HWIO_SNOC_USB3_TFILT_ID_COREID_ADDR A:0x60581100
y.create.l HWIO_SNOC_USB3_TFILT_ID_REVISIONID_ADDR A:0x60581104
y.create.l HWIO_SNOC_USB3_TFILT_MODE_ADDR A:0x60581108
y.create.l HWIO_SNOC_USB3_TFILT_ADDRBASE_LOW_ADDR A:0x6058110c
y.create.l HWIO_SNOC_USB3_TFILT_ADDRWINDOWSIZE_ADDR A:0x60581114
y.create.l HWIO_SNOC_USB3_TFILT_SRCIDBASE_ADDR A:0x60581118
y.create.l HWIO_SNOC_USB3_TFILT_SRCIDMASK_ADDR A:0x6058111c
y.create.l HWIO_SNOC_USB3_TFILT_OPCODE_ADDR A:0x60581120
y.create.l HWIO_SNOC_USB3_TFILT_USERBASE_ADDR A:0x60581124
y.create.l HWIO_SNOC_USB3_TFILT_USERMASK_ADDR A:0x60581128
y.create.l HWIO_SNOC_PCIE_TFILT_ID_COREID_ADDR A:0x60581180
y.create.l HWIO_SNOC_PCIE_TFILT_ID_REVISIONID_ADDR A:0x60581184
y.create.l HWIO_SNOC_PCIE_TFILT_MODE_ADDR A:0x60581188
y.create.l HWIO_SNOC_PCIE_TFILT_ADDRBASE_LOW_ADDR A:0x6058118c
y.create.l HWIO_SNOC_PCIE_TFILT_ADDRWINDOWSIZE_ADDR A:0x60581194
y.create.l HWIO_SNOC_PCIE_TFILT_SRCIDBASE_ADDR A:0x60581198
y.create.l HWIO_SNOC_PCIE_TFILT_SRCIDMASK_ADDR A:0x6058119c
y.create.l HWIO_SNOC_PCIE_TFILT_OPCODE_ADDR A:0x605811a0
y.create.l HWIO_SNOC_PCIE_TFILT_USERBASE_ADDR A:0x605811a4
y.create.l HWIO_SNOC_PCIE_TFILT_USERMASK_ADDR A:0x605811a8
y.create.l HWIO_SNOC_QDSS_BAM_TFILT_ID_COREID_ADDR A:0x60581200
y.create.l HWIO_SNOC_QDSS_BAM_TFILT_ID_REVISIONID_ADDR A:0x60581204
y.create.l HWIO_SNOC_QDSS_BAM_TFILT_MODE_ADDR A:0x60581208
y.create.l HWIO_SNOC_QDSS_BAM_TFILT_ADDRBASE_LOW_ADDR A:0x6058120c
y.create.l HWIO_SNOC_QDSS_BAM_TFILT_ADDRWINDOWSIZE_ADDR A:0x60581214
y.create.l HWIO_SNOC_QDSS_BAM_TFILT_SRCIDBASE_ADDR A:0x60581218
y.create.l HWIO_SNOC_QDSS_BAM_TFILT_SRCIDMASK_ADDR A:0x6058121c
y.create.l HWIO_SNOC_QDSS_BAM_TFILT_OPCODE_ADDR A:0x60581220
y.create.l HWIO_SNOC_QDSS_BAM_TFILT_USERBASE_ADDR A:0x60581224
y.create.l HWIO_SNOC_QDSS_BAM_TFILT_USERMASK_ADDR A:0x60581228
y.create.l HWIO_SNOC_PCNOC_TFILT_ID_COREID_ADDR A:0x60581280
y.create.l HWIO_SNOC_PCNOC_TFILT_ID_REVISIONID_ADDR A:0x60581284
y.create.l HWIO_SNOC_PCNOC_TFILT_MODE_ADDR A:0x60581288
y.create.l HWIO_SNOC_PCNOC_TFILT_ADDRBASE_LOW_ADDR A:0x6058128c
y.create.l HWIO_SNOC_PCNOC_TFILT_ADDRBASE_HIGH_ADDR A:0x60581290
y.create.l HWIO_SNOC_PCNOC_TFILT_ADDRWINDOWSIZE_ADDR A:0x60581294
y.create.l HWIO_SNOC_PCNOC_TFILT_SRCIDBASE_ADDR A:0x60581298
y.create.l HWIO_SNOC_PCNOC_TFILT_SRCIDMASK_ADDR A:0x6058129c
y.create.l HWIO_SNOC_PCNOC_TFILT_OPCODE_ADDR A:0x605812a0
y.create.l HWIO_SNOC_PCNOC_TFILT_USERBASE_ADDR A:0x605812a4
y.create.l HWIO_SNOC_PCNOC_TFILT_USERMASK_ADDR A:0x605812a8
y.create.l HWIO_SNOC_BIMC_TFILT_ID_COREID_ADDR A:0x60581300
y.create.l HWIO_SNOC_BIMC_TFILT_ID_REVISIONID_ADDR A:0x60581304
y.create.l HWIO_SNOC_BIMC_TFILT_MODE_ADDR A:0x60581308
y.create.l HWIO_SNOC_BIMC_TFILT_ADDRBASE_LOW_ADDR A:0x6058130c
y.create.l HWIO_SNOC_BIMC_TFILT_ADDRBASE_HIGH_ADDR A:0x60581310
y.create.l HWIO_SNOC_BIMC_TFILT_ADDRWINDOWSIZE_ADDR A:0x60581314
y.create.l HWIO_SNOC_BIMC_TFILT_SRCIDBASE_ADDR A:0x60581318
y.create.l HWIO_SNOC_BIMC_TFILT_SRCIDMASK_ADDR A:0x6058131c
y.create.l HWIO_SNOC_BIMC_TFILT_OPCODE_ADDR A:0x60581320
y.create.l HWIO_SNOC_BIMC_TFILT_USERBASE_ADDR A:0x60581324
y.create.l HWIO_SNOC_BIMC_TFILT_USERMASK_ADDR A:0x60581328
y.create.l HWIO_SNOC_IPA_TFILT_ID_COREID_ADDR A:0x60581380
y.create.l HWIO_SNOC_IPA_TFILT_ID_REVISIONID_ADDR A:0x60581384
y.create.l HWIO_SNOC_IPA_TFILT_MODE_ADDR A:0x60581388
y.create.l HWIO_SNOC_IPA_TFILT_ADDRBASE_LOW_ADDR A:0x6058138c
y.create.l HWIO_SNOC_IPA_TFILT_ADDRBASE_HIGH_ADDR A:0x60581390
y.create.l HWIO_SNOC_IPA_TFILT_ADDRWINDOWSIZE_ADDR A:0x60581394
y.create.l HWIO_SNOC_IPA_TFILT_SRCIDBASE_ADDR A:0x60581398
y.create.l HWIO_SNOC_IPA_TFILT_SRCIDMASK_ADDR A:0x6058139c
y.create.l HWIO_SNOC_IPA_TFILT_OPCODE_ADDR A:0x605813a0
y.create.l HWIO_SNOC_IPA_TFILT_USERBASE_ADDR A:0x605813a4
y.create.l HWIO_SNOC_IPA_TFILT_USERMASK_ADDR A:0x605813a8
y.create.l HWIO_SNOC_QDSS_ETR_TFILT_ID_COREID_ADDR A:0x60581400
y.create.l HWIO_SNOC_QDSS_ETR_TFILT_ID_REVISIONID_ADDR A:0x60581404
y.create.l HWIO_SNOC_QDSS_ETR_TFILT_MODE_ADDR A:0x60581408
y.create.l HWIO_SNOC_QDSS_ETR_TFILT_ADDRBASE_LOW_ADDR A:0x6058140c
y.create.l HWIO_SNOC_QDSS_ETR_TFILT_ADDRWINDOWSIZE_ADDR A:0x60581414
y.create.l HWIO_SNOC_QDSS_ETR_TFILT_SRCIDBASE_ADDR A:0x60581418
y.create.l HWIO_SNOC_QDSS_ETR_TFILT_SRCIDMASK_ADDR A:0x6058141c
y.create.l HWIO_SNOC_QDSS_ETR_TFILT_OPCODE_ADDR A:0x60581420
y.create.l HWIO_SNOC_QDSS_ETR_TFILT_USERBASE_ADDR A:0x60581424
y.create.l HWIO_SNOC_QDSS_ETR_TFILT_USERMASK_ADDR A:0x60581428
y.create.l HWIO_SNOC_TPRB0_TPROF_ID_COREID_ADDR A:0x60582000
y.create.l HWIO_SNOC_TPRB0_TPROF_ID_REVISIONID_ADDR A:0x60582004
y.create.l HWIO_SNOC_TPRB0_TPROF_EN_ADDR A:0x60582008
y.create.l HWIO_SNOC_TPRB0_TPROF_MODE_ADDR A:0x6058200c
y.create.l HWIO_SNOC_TPRB0_TPROF_OBSERVEDSEL_0_ADDR A:0x60582010
y.create.l HWIO_SNOC_TPRB0_TPROF_OBSERVEDSEL_1_ADDR A:0x60582014
y.create.l HWIO_SNOC_TPRB0_TPROF_NTENURELINES_0_ADDR A:0x60582020
y.create.l HWIO_SNOC_TPRB0_TPROF_THRESHOLDS_0_0_ADDR A:0x6058202c
y.create.l HWIO_SNOC_TPRB0_TPROF_THRESHOLDS_0_1_ADDR A:0x60582030
y.create.l HWIO_SNOC_TPRB0_TPROF_THRESHOLDS_0_2_ADDR A:0x60582034
y.create.l HWIO_SNOC_TPRB0_TPROF_THRESHOLDS_1_0_ADDR A:0x6058203c
y.create.l HWIO_SNOC_TPRB0_TPROF_THRESHOLDS_1_1_ADDR A:0x60582040
y.create.l HWIO_SNOC_TPRB0_TPROF_THRESHOLDS_1_2_ADDR A:0x60582044
y.create.l HWIO_SNOC_TPRB0_TPROF_OVERFLOWSTATUS_ADDR A:0x6058206c
y.create.l HWIO_SNOC_TPRB0_TPROF_OVERFLOWRESET_ADDR A:0x60582070
y.create.l HWIO_SNOC_TPRB0_TPROF_PENDINGEVENTMODE_ADDR A:0x60582074
y.create.l HWIO_SNOC_TPRB0_TPROF_PRESCALER_ADDR A:0x60582078
y.create.l HWIO_SNOC_TPRB1_TPROF_ID_COREID_ADDR A:0x60582080
y.create.l HWIO_SNOC_TPRB1_TPROF_ID_REVISIONID_ADDR A:0x60582084
y.create.l HWIO_SNOC_TPRB1_TPROF_EN_ADDR A:0x60582088
y.create.l HWIO_SNOC_TPRB1_TPROF_MODE_ADDR A:0x6058208c
y.create.l HWIO_SNOC_TPRB1_TPROF_OBSERVEDSEL_0_ADDR A:0x60582090
y.create.l HWIO_SNOC_TPRB1_TPROF_OBSERVEDSEL_1_ADDR A:0x60582094
y.create.l HWIO_SNOC_TPRB1_TPROF_NTENURELINES_0_ADDR A:0x605820a0
y.create.l HWIO_SNOC_TPRB1_TPROF_THRESHOLDS_0_0_ADDR A:0x605820ac
y.create.l HWIO_SNOC_TPRB1_TPROF_THRESHOLDS_0_1_ADDR A:0x605820b0
y.create.l HWIO_SNOC_TPRB1_TPROF_THRESHOLDS_0_2_ADDR A:0x605820b4
y.create.l HWIO_SNOC_TPRB1_TPROF_THRESHOLDS_1_0_ADDR A:0x605820bc
y.create.l HWIO_SNOC_TPRB1_TPROF_THRESHOLDS_1_1_ADDR A:0x605820c0
y.create.l HWIO_SNOC_TPRB1_TPROF_THRESHOLDS_1_2_ADDR A:0x605820c4
y.create.l HWIO_SNOC_TPRB1_TPROF_OVERFLOWSTATUS_ADDR A:0x605820ec
y.create.l HWIO_SNOC_TPRB1_TPROF_OVERFLOWRESET_ADDR A:0x605820f0
y.create.l HWIO_SNOC_TPRB1_TPROF_PENDINGEVENTMODE_ADDR A:0x605820f4
y.create.l HWIO_SNOC_TPRB1_TPROF_PRESCALER_ADDR A:0x605820f8
y.create.l HWIO_SNOC_TPRB2_TPROF_ID_COREID_ADDR A:0x60582100
y.create.l HWIO_SNOC_TPRB2_TPROF_ID_REVISIONID_ADDR A:0x60582104
y.create.l HWIO_SNOC_TPRB2_TPROF_EN_ADDR A:0x60582108
y.create.l HWIO_SNOC_TPRB2_TPROF_MODE_ADDR A:0x6058210c
y.create.l HWIO_SNOC_TPRB2_TPROF_OBSERVEDSEL_0_ADDR A:0x60582110
y.create.l HWIO_SNOC_TPRB2_TPROF_OBSERVEDSEL_1_ADDR A:0x60582114
y.create.l HWIO_SNOC_TPRB2_TPROF_NTENURELINES_0_ADDR A:0x60582120
y.create.l HWIO_SNOC_TPRB2_TPROF_THRESHOLDS_0_0_ADDR A:0x6058212c
y.create.l HWIO_SNOC_TPRB2_TPROF_THRESHOLDS_0_1_ADDR A:0x60582130
y.create.l HWIO_SNOC_TPRB2_TPROF_THRESHOLDS_0_2_ADDR A:0x60582134
y.create.l HWIO_SNOC_TPRB2_TPROF_THRESHOLDS_1_0_ADDR A:0x6058213c
y.create.l HWIO_SNOC_TPRB2_TPROF_THRESHOLDS_1_1_ADDR A:0x60582140
y.create.l HWIO_SNOC_TPRB2_TPROF_THRESHOLDS_1_2_ADDR A:0x60582144
y.create.l HWIO_SNOC_TPRB2_TPROF_OVERFLOWSTATUS_ADDR A:0x6058216c
y.create.l HWIO_SNOC_TPRB2_TPROF_OVERFLOWRESET_ADDR A:0x60582170
y.create.l HWIO_SNOC_TPRB2_TPROF_PENDINGEVENTMODE_ADDR A:0x60582174
y.create.l HWIO_SNOC_TPRB2_TPROF_PRESCALER_ADDR A:0x60582178
y.create.l HWIO_SNOC_EPRB0_SPROF_ID_COREID_ADDR A:0x60583000
y.create.l HWIO_SNOC_EPRB0_SPROF_ID_REVISIONID_ADDR A:0x60583004
y.create.l HWIO_SNOC_EPRB0_SPROF_MAINCTL_ADDR A:0x60583008
y.create.l HWIO_SNOC_EPRB0_SPROF_CFGCTL_ADDR A:0x6058300c
y.create.l HWIO_SNOC_EPRB0_SPROF_TRACEPORTSEL_ADDR A:0x60583010
y.create.l HWIO_SNOC_EPRB0_SPROF_FILTERLUT_ADDR A:0x60583014
y.create.l HWIO_SNOC_EPRB0_SPROF_TRACEALARMEN_ADDR A:0x60583018
y.create.l HWIO_SNOC_EPRB0_SPROF_TRACEALARMSTATUS_ADDR A:0x6058301c
y.create.l HWIO_SNOC_EPRB0_SPROF_TRACEALARMCLR_ADDR A:0x60583020
y.create.l HWIO_SNOC_EPRB0_SPROF_STATPERIOD_ADDR A:0x60583024
y.create.l HWIO_SNOC_EPRB0_SPROF_STATGO_ADDR A:0x60583028
y.create.l HWIO_SNOC_EPRB0_SPROF_STATALARMMIN_ADDR A:0x6058302c
y.create.l HWIO_SNOC_EPRB0_SPROF_STATALARMMAX_ADDR A:0x60583030
y.create.l HWIO_SNOC_EPRB0_SPROF_STATALARMSTATUS_ADDR A:0x60583034
y.create.l HWIO_SNOC_EPRB0_SPROF_STATALARMCLR_ADDR A:0x60583038
y.create.l HWIO_SNOC_EPRB0_SPROF_FILTERS_0_ROUTEIDBASE_ADDR A:0x60583044
y.create.l HWIO_SNOC_EPRB0_SPROF_FILTERS_0_ROUTEIDMASK_ADDR A:0x60583048
y.create.l HWIO_SNOC_EPRB0_SPROF_FILTERS_0_ADDRBASE_LOW_ADDR A:0x6058304c
y.create.l HWIO_SNOC_EPRB0_SPROF_FILTERS_0_ADDRBASE_HIGH_ADDR A:0x60583050
y.create.l HWIO_SNOC_EPRB0_SPROF_FILTERS_0_WINDOWSIZE_ADDR A:0x60583054
y.create.l HWIO_SNOC_EPRB0_SPROF_FILTERS_0_OPCODE_ADDR A:0x60583060
y.create.l HWIO_SNOC_EPRB0_SPROF_FILTERS_0_STATUS_ADDR A:0x60583064
y.create.l HWIO_SNOC_EPRB0_SPROF_FILTERS_0_LENGTH_ADDR A:0x60583068
y.create.l HWIO_SNOC_EPRB0_SPROF_FILTERS_0_URGENCY_ADDR A:0x6058306c
y.create.l HWIO_SNOC_EPRB0_SPROF_FILTERS_1_ROUTEIDBASE_ADDR A:0x60583080
y.create.l HWIO_SNOC_EPRB0_SPROF_FILTERS_1_ROUTEIDMASK_ADDR A:0x60583084
y.create.l HWIO_SNOC_EPRB0_SPROF_FILTERS_1_ADDRBASE_LOW_ADDR A:0x60583088
y.create.l HWIO_SNOC_EPRB0_SPROF_FILTERS_1_ADDRBASE_HIGH_ADDR A:0x6058308c
y.create.l HWIO_SNOC_EPRB0_SPROF_FILTERS_1_WINDOWSIZE_ADDR A:0x60583090
y.create.l HWIO_SNOC_EPRB0_SPROF_FILTERS_1_OPCODE_ADDR A:0x6058309c
y.create.l HWIO_SNOC_EPRB0_SPROF_FILTERS_1_STATUS_ADDR A:0x605830a0
y.create.l HWIO_SNOC_EPRB0_SPROF_FILTERS_1_LENGTH_ADDR A:0x605830a4
y.create.l HWIO_SNOC_EPRB0_SPROF_FILTERS_1_URGENCY_ADDR A:0x605830a8
y.create.l HWIO_SNOC_EPRB0_SPROF_FILTERS_2_ROUTEIDBASE_ADDR A:0x605830bc
y.create.l HWIO_SNOC_EPRB0_SPROF_FILTERS_2_ROUTEIDMASK_ADDR A:0x605830c0
y.create.l HWIO_SNOC_EPRB0_SPROF_FILTERS_2_ADDRBASE_LOW_ADDR A:0x605830c4
y.create.l HWIO_SNOC_EPRB0_SPROF_FILTERS_2_ADDRBASE_HIGH_ADDR A:0x605830c8
y.create.l HWIO_SNOC_EPRB0_SPROF_FILTERS_2_WINDOWSIZE_ADDR A:0x605830cc
y.create.l HWIO_SNOC_EPRB0_SPROF_FILTERS_2_OPCODE_ADDR A:0x605830d8
y.create.l HWIO_SNOC_EPRB0_SPROF_FILTERS_2_STATUS_ADDR A:0x605830dc
y.create.l HWIO_SNOC_EPRB0_SPROF_FILTERS_2_LENGTH_ADDR A:0x605830e0
y.create.l HWIO_SNOC_EPRB0_SPROF_FILTERS_2_URGENCY_ADDR A:0x605830e4
y.create.l HWIO_SNOC_EPRB0_SPROF_FILTERS_3_ROUTEIDBASE_ADDR A:0x605830f8
y.create.l HWIO_SNOC_EPRB0_SPROF_FILTERS_3_ROUTEIDMASK_ADDR A:0x605830fc
y.create.l HWIO_SNOC_EPRB0_SPROF_FILTERS_3_ADDRBASE_LOW_ADDR A:0x60583100
y.create.l HWIO_SNOC_EPRB0_SPROF_FILTERS_3_ADDRBASE_HIGH_ADDR A:0x60583104
y.create.l HWIO_SNOC_EPRB0_SPROF_FILTERS_3_WINDOWSIZE_ADDR A:0x60583108
y.create.l HWIO_SNOC_EPRB0_SPROF_FILTERS_3_OPCODE_ADDR A:0x60583114
y.create.l HWIO_SNOC_EPRB0_SPROF_FILTERS_3_STATUS_ADDR A:0x60583118
y.create.l HWIO_SNOC_EPRB0_SPROF_FILTERS_3_LENGTH_ADDR A:0x6058311c
y.create.l HWIO_SNOC_EPRB0_SPROF_FILTERS_3_URGENCY_ADDR A:0x60583120
y.create.l HWIO_SNOC_EPRB0_SPROF_COUNTERS_0_PORTSEL_ADDR A:0x60583134
y.create.l HWIO_SNOC_EPRB0_SPROF_COUNTERS_0_SRC_ADDR A:0x60583138
y.create.l HWIO_SNOC_EPRB0_SPROF_COUNTERS_0_ALARMMODE_ADDR A:0x6058313c
y.create.l HWIO_SNOC_EPRB0_SPROF_COUNTERS_0_VAL_ADDR A:0x60583140
y.create.l HWIO_SNOC_EPRB0_SPROF_COUNTERS_1_PORTSEL_ADDR A:0x60583148
y.create.l HWIO_SNOC_EPRB0_SPROF_COUNTERS_1_SRC_ADDR A:0x6058314c
y.create.l HWIO_SNOC_EPRB0_SPROF_COUNTERS_1_ALARMMODE_ADDR A:0x60583150
y.create.l HWIO_SNOC_EPRB0_SPROF_COUNTERS_1_VAL_ADDR A:0x60583154
y.create.l HWIO_SNOC_EPRB0_SPROF_COUNTERS_2_PORTSEL_ADDR A:0x6058315c
y.create.l HWIO_SNOC_EPRB0_SPROF_COUNTERS_2_SRC_ADDR A:0x60583160
y.create.l HWIO_SNOC_EPRB0_SPROF_COUNTERS_2_ALARMMODE_ADDR A:0x60583164
y.create.l HWIO_SNOC_EPRB0_SPROF_COUNTERS_2_VAL_ADDR A:0x60583168
y.create.l HWIO_SNOC_EPRB0_SPROF_COUNTERS_3_PORTSEL_ADDR A:0x60583170
y.create.l HWIO_SNOC_EPRB0_SPROF_COUNTERS_3_SRC_ADDR A:0x60583174
y.create.l HWIO_SNOC_EPRB0_SPROF_COUNTERS_3_ALARMMODE_ADDR A:0x60583178
y.create.l HWIO_SNOC_EPRB0_SPROF_COUNTERS_3_VAL_ADDR A:0x6058317c
y.create.l HWIO_SNOC_EPRB0_SPROF_COUNTERS_4_PORTSEL_ADDR A:0x60583184
y.create.l HWIO_SNOC_EPRB0_SPROF_COUNTERS_4_SRC_ADDR A:0x60583188
y.create.l HWIO_SNOC_EPRB0_SPROF_COUNTERS_4_ALARMMODE_ADDR A:0x6058318c
y.create.l HWIO_SNOC_EPRB0_SPROF_COUNTERS_4_VAL_ADDR A:0x60583190
y.create.l HWIO_SNOC_EPRB0_SPROF_COUNTERS_5_PORTSEL_ADDR A:0x60583198
y.create.l HWIO_SNOC_EPRB0_SPROF_COUNTERS_5_SRC_ADDR A:0x6058319c
y.create.l HWIO_SNOC_EPRB0_SPROF_COUNTERS_5_ALARMMODE_ADDR A:0x605831a0
y.create.l HWIO_SNOC_EPRB0_SPROF_COUNTERS_5_VAL_ADDR A:0x605831a4
y.create.l HWIO_SNOC_EPRB0_SPROF_COUNTERS_6_PORTSEL_ADDR A:0x605831ac
y.create.l HWIO_SNOC_EPRB0_SPROF_COUNTERS_6_SRC_ADDR A:0x605831b0
y.create.l HWIO_SNOC_EPRB0_SPROF_COUNTERS_6_ALARMMODE_ADDR A:0x605831b4
y.create.l HWIO_SNOC_EPRB0_SPROF_COUNTERS_6_VAL_ADDR A:0x605831b8
y.create.l HWIO_SNOC_EPRB0_SPROF_COUNTERS_7_PORTSEL_ADDR A:0x605831c0
y.create.l HWIO_SNOC_EPRB0_SPROF_COUNTERS_7_SRC_ADDR A:0x605831c4
y.create.l HWIO_SNOC_EPRB0_SPROF_COUNTERS_7_ALARMMODE_ADDR A:0x605831c8
y.create.l HWIO_SNOC_EPRB0_SPROF_COUNTERS_7_VAL_ADDR A:0x605831cc
y.create.l HWIO_SNOC_EPRB0_SPROF_COUNTERS_8_PORTSEL_ADDR A:0x605831d4
y.create.l HWIO_SNOC_EPRB0_SPROF_COUNTERS_8_SRC_ADDR A:0x605831d8
y.create.l HWIO_SNOC_EPRB0_SPROF_COUNTERS_8_ALARMMODE_ADDR A:0x605831dc
y.create.l HWIO_SNOC_EPRB0_SPROF_COUNTERS_8_VAL_ADDR A:0x605831e0
y.create.l HWIO_SNOC_EPRB0_SPROF_COUNTERS_9_PORTSEL_ADDR A:0x605831e8
y.create.l HWIO_SNOC_EPRB0_SPROF_COUNTERS_9_SRC_ADDR A:0x605831ec
y.create.l HWIO_SNOC_EPRB0_SPROF_COUNTERS_9_ALARMMODE_ADDR A:0x605831f0
y.create.l HWIO_SNOC_EPRB0_SPROF_COUNTERS_9_VAL_ADDR A:0x605831f4
y.create.l HWIO_SNOC_EPRB1_SPROF_ID_COREID_ADDR A:0x60583400
y.create.l HWIO_SNOC_EPRB1_SPROF_ID_REVISIONID_ADDR A:0x60583404
y.create.l HWIO_SNOC_EPRB1_SPROF_MAINCTL_ADDR A:0x60583408
y.create.l HWIO_SNOC_EPRB1_SPROF_CFGCTL_ADDR A:0x6058340c
y.create.l HWIO_SNOC_EPRB1_SPROF_TRACEPORTSEL_ADDR A:0x60583410
y.create.l HWIO_SNOC_EPRB1_SPROF_FILTERLUT_ADDR A:0x60583414
y.create.l HWIO_SNOC_EPRB1_SPROF_TRACEALARMEN_ADDR A:0x60583418
y.create.l HWIO_SNOC_EPRB1_SPROF_TRACEALARMSTATUS_ADDR A:0x6058341c
y.create.l HWIO_SNOC_EPRB1_SPROF_TRACEALARMCLR_ADDR A:0x60583420
y.create.l HWIO_SNOC_EPRB1_SPROF_STATPERIOD_ADDR A:0x60583424
y.create.l HWIO_SNOC_EPRB1_SPROF_STATGO_ADDR A:0x60583428
y.create.l HWIO_SNOC_EPRB1_SPROF_STATALARMMIN_ADDR A:0x6058342c
y.create.l HWIO_SNOC_EPRB1_SPROF_STATALARMMAX_ADDR A:0x60583430
y.create.l HWIO_SNOC_EPRB1_SPROF_STATALARMSTATUS_ADDR A:0x60583434
y.create.l HWIO_SNOC_EPRB1_SPROF_STATALARMCLR_ADDR A:0x60583438
y.create.l HWIO_SNOC_EPRB1_SPROF_FILTERS_0_ROUTEIDBASE_ADDR A:0x60583444
y.create.l HWIO_SNOC_EPRB1_SPROF_FILTERS_0_ROUTEIDMASK_ADDR A:0x60583448
y.create.l HWIO_SNOC_EPRB1_SPROF_FILTERS_0_ADDRBASE_LOW_ADDR A:0x6058344c
y.create.l HWIO_SNOC_EPRB1_SPROF_FILTERS_0_ADDRBASE_HIGH_ADDR A:0x60583450
y.create.l HWIO_SNOC_EPRB1_SPROF_FILTERS_0_WINDOWSIZE_ADDR A:0x60583454
y.create.l HWIO_SNOC_EPRB1_SPROF_FILTERS_0_OPCODE_ADDR A:0x60583460
y.create.l HWIO_SNOC_EPRB1_SPROF_FILTERS_0_STATUS_ADDR A:0x60583464
y.create.l HWIO_SNOC_EPRB1_SPROF_FILTERS_0_LENGTH_ADDR A:0x60583468
y.create.l HWIO_SNOC_EPRB1_SPROF_FILTERS_0_URGENCY_ADDR A:0x6058346c
y.create.l HWIO_SNOC_EPRB1_SPROF_FILTERS_1_ROUTEIDBASE_ADDR A:0x60583480
y.create.l HWIO_SNOC_EPRB1_SPROF_FILTERS_1_ROUTEIDMASK_ADDR A:0x60583484
y.create.l HWIO_SNOC_EPRB1_SPROF_FILTERS_1_ADDRBASE_LOW_ADDR A:0x60583488
y.create.l HWIO_SNOC_EPRB1_SPROF_FILTERS_1_ADDRBASE_HIGH_ADDR A:0x6058348c
y.create.l HWIO_SNOC_EPRB1_SPROF_FILTERS_1_WINDOWSIZE_ADDR A:0x60583490
y.create.l HWIO_SNOC_EPRB1_SPROF_FILTERS_1_OPCODE_ADDR A:0x6058349c
y.create.l HWIO_SNOC_EPRB1_SPROF_FILTERS_1_STATUS_ADDR A:0x605834a0
y.create.l HWIO_SNOC_EPRB1_SPROF_FILTERS_1_LENGTH_ADDR A:0x605834a4
y.create.l HWIO_SNOC_EPRB1_SPROF_FILTERS_1_URGENCY_ADDR A:0x605834a8
y.create.l HWIO_SNOC_EPRB1_SPROF_FILTERS_2_ROUTEIDBASE_ADDR A:0x605834bc
y.create.l HWIO_SNOC_EPRB1_SPROF_FILTERS_2_ROUTEIDMASK_ADDR A:0x605834c0
y.create.l HWIO_SNOC_EPRB1_SPROF_FILTERS_2_ADDRBASE_LOW_ADDR A:0x605834c4
y.create.l HWIO_SNOC_EPRB1_SPROF_FILTERS_2_ADDRBASE_HIGH_ADDR A:0x605834c8
y.create.l HWIO_SNOC_EPRB1_SPROF_FILTERS_2_WINDOWSIZE_ADDR A:0x605834cc
y.create.l HWIO_SNOC_EPRB1_SPROF_FILTERS_2_OPCODE_ADDR A:0x605834d8
y.create.l HWIO_SNOC_EPRB1_SPROF_FILTERS_2_STATUS_ADDR A:0x605834dc
y.create.l HWIO_SNOC_EPRB1_SPROF_FILTERS_2_LENGTH_ADDR A:0x605834e0
y.create.l HWIO_SNOC_EPRB1_SPROF_FILTERS_2_URGENCY_ADDR A:0x605834e4
y.create.l HWIO_SNOC_EPRB1_SPROF_FILTERS_3_ROUTEIDBASE_ADDR A:0x605834f8
y.create.l HWIO_SNOC_EPRB1_SPROF_FILTERS_3_ROUTEIDMASK_ADDR A:0x605834fc
y.create.l HWIO_SNOC_EPRB1_SPROF_FILTERS_3_ADDRBASE_LOW_ADDR A:0x60583500
y.create.l HWIO_SNOC_EPRB1_SPROF_FILTERS_3_ADDRBASE_HIGH_ADDR A:0x60583504
y.create.l HWIO_SNOC_EPRB1_SPROF_FILTERS_3_WINDOWSIZE_ADDR A:0x60583508
y.create.l HWIO_SNOC_EPRB1_SPROF_FILTERS_3_OPCODE_ADDR A:0x60583514
y.create.l HWIO_SNOC_EPRB1_SPROF_FILTERS_3_STATUS_ADDR A:0x60583518
y.create.l HWIO_SNOC_EPRB1_SPROF_FILTERS_3_LENGTH_ADDR A:0x6058351c
y.create.l HWIO_SNOC_EPRB1_SPROF_FILTERS_3_URGENCY_ADDR A:0x60583520
y.create.l HWIO_SNOC_EPRB1_SPROF_COUNTERS_0_PORTSEL_ADDR A:0x60583534
y.create.l HWIO_SNOC_EPRB1_SPROF_COUNTERS_0_SRC_ADDR A:0x60583538
y.create.l HWIO_SNOC_EPRB1_SPROF_COUNTERS_0_ALARMMODE_ADDR A:0x6058353c
y.create.l HWIO_SNOC_EPRB1_SPROF_COUNTERS_0_VAL_ADDR A:0x60583540
y.create.l HWIO_SNOC_EPRB1_SPROF_COUNTERS_1_PORTSEL_ADDR A:0x60583548
y.create.l HWIO_SNOC_EPRB1_SPROF_COUNTERS_1_SRC_ADDR A:0x6058354c
y.create.l HWIO_SNOC_EPRB1_SPROF_COUNTERS_1_ALARMMODE_ADDR A:0x60583550
y.create.l HWIO_SNOC_EPRB1_SPROF_COUNTERS_1_VAL_ADDR A:0x60583554
y.create.l HWIO_SNOC_EPRB1_SPROF_COUNTERS_2_PORTSEL_ADDR A:0x6058355c
y.create.l HWIO_SNOC_EPRB1_SPROF_COUNTERS_2_SRC_ADDR A:0x60583560
y.create.l HWIO_SNOC_EPRB1_SPROF_COUNTERS_2_ALARMMODE_ADDR A:0x60583564
y.create.l HWIO_SNOC_EPRB1_SPROF_COUNTERS_2_VAL_ADDR A:0x60583568
y.create.l HWIO_SNOC_EPRB1_SPROF_COUNTERS_3_PORTSEL_ADDR A:0x60583570
y.create.l HWIO_SNOC_EPRB1_SPROF_COUNTERS_3_SRC_ADDR A:0x60583574
y.create.l HWIO_SNOC_EPRB1_SPROF_COUNTERS_3_ALARMMODE_ADDR A:0x60583578
y.create.l HWIO_SNOC_EPRB1_SPROF_COUNTERS_3_VAL_ADDR A:0x6058357c
y.create.l HWIO_SNOC_EPRB1_SPROF_COUNTERS_4_PORTSEL_ADDR A:0x60583584
y.create.l HWIO_SNOC_EPRB1_SPROF_COUNTERS_4_SRC_ADDR A:0x60583588
y.create.l HWIO_SNOC_EPRB1_SPROF_COUNTERS_4_ALARMMODE_ADDR A:0x6058358c
y.create.l HWIO_SNOC_EPRB1_SPROF_COUNTERS_4_VAL_ADDR A:0x60583590
y.create.l HWIO_SNOC_EPRB1_SPROF_COUNTERS_5_PORTSEL_ADDR A:0x60583598
y.create.l HWIO_SNOC_EPRB1_SPROF_COUNTERS_5_SRC_ADDR A:0x6058359c
y.create.l HWIO_SNOC_EPRB1_SPROF_COUNTERS_5_ALARMMODE_ADDR A:0x605835a0
y.create.l HWIO_SNOC_EPRB1_SPROF_COUNTERS_5_VAL_ADDR A:0x605835a4
y.create.l HWIO_SNOC_EPRB1_SPROF_COUNTERS_6_PORTSEL_ADDR A:0x605835ac
y.create.l HWIO_SNOC_EPRB1_SPROF_COUNTERS_6_SRC_ADDR A:0x605835b0
y.create.l HWIO_SNOC_EPRB1_SPROF_COUNTERS_6_ALARMMODE_ADDR A:0x605835b4
y.create.l HWIO_SNOC_EPRB1_SPROF_COUNTERS_6_VAL_ADDR A:0x605835b8
y.create.l HWIO_SNOC_EPRB1_SPROF_COUNTERS_7_PORTSEL_ADDR A:0x605835c0
y.create.l HWIO_SNOC_EPRB1_SPROF_COUNTERS_7_SRC_ADDR A:0x605835c4
y.create.l HWIO_SNOC_EPRB1_SPROF_COUNTERS_7_ALARMMODE_ADDR A:0x605835c8
y.create.l HWIO_SNOC_EPRB1_SPROF_COUNTERS_7_VAL_ADDR A:0x605835cc
y.create.l HWIO_SNOC_EPRB1_SPROF_COUNTERS_8_PORTSEL_ADDR A:0x605835d4
y.create.l HWIO_SNOC_EPRB1_SPROF_COUNTERS_8_SRC_ADDR A:0x605835d8
y.create.l HWIO_SNOC_EPRB1_SPROF_COUNTERS_8_ALARMMODE_ADDR A:0x605835dc
y.create.l HWIO_SNOC_EPRB1_SPROF_COUNTERS_8_VAL_ADDR A:0x605835e0
y.create.l HWIO_SNOC_EPRB1_SPROF_COUNTERS_9_PORTSEL_ADDR A:0x605835e8
y.create.l HWIO_SNOC_EPRB1_SPROF_COUNTERS_9_SRC_ADDR A:0x605835ec
y.create.l HWIO_SNOC_EPRB1_SPROF_COUNTERS_9_ALARMMODE_ADDR A:0x605835f0
y.create.l HWIO_SNOC_EPRB1_SPROF_COUNTERS_9_VAL_ADDR A:0x605835f4
y.create.l HWIO_SNOC_TPRB0_SPROF_ID_COREID_ADDR A:0x60584000
y.create.l HWIO_SNOC_TPRB0_SPROF_ID_REVISIONID_ADDR A:0x60584004
y.create.l HWIO_SNOC_TPRB0_SPROF_MAINCTL_ADDR A:0x60584008
y.create.l HWIO_SNOC_TPRB0_SPROF_CFGCTL_ADDR A:0x6058400c
y.create.l HWIO_SNOC_TPRB0_SPROF_STATPERIOD_ADDR A:0x60584024
y.create.l HWIO_SNOC_TPRB0_SPROF_STATGO_ADDR A:0x60584028
y.create.l HWIO_SNOC_TPRB0_SPROF_STATALARMMIN_ADDR A:0x6058402c
y.create.l HWIO_SNOC_TPRB0_SPROF_STATALARMMAX_ADDR A:0x60584030
y.create.l HWIO_SNOC_TPRB0_SPROF_STATALARMSTATUS_ADDR A:0x60584034
y.create.l HWIO_SNOC_TPRB0_SPROF_STATALARMCLR_ADDR A:0x60584038
y.create.l HWIO_SNOC_TPRB0_SPROF_COUNTERS_0_SRC_ADDR A:0x60584138
y.create.l HWIO_SNOC_TPRB0_SPROF_COUNTERS_0_ALARMMODE_ADDR A:0x6058413c
y.create.l HWIO_SNOC_TPRB0_SPROF_COUNTERS_0_VAL_ADDR A:0x60584140
y.create.l HWIO_SNOC_TPRB0_SPROF_COUNTERS_1_SRC_ADDR A:0x6058414c
y.create.l HWIO_SNOC_TPRB0_SPROF_COUNTERS_1_ALARMMODE_ADDR A:0x60584150
y.create.l HWIO_SNOC_TPRB0_SPROF_COUNTERS_1_VAL_ADDR A:0x60584154
y.create.l HWIO_SNOC_TPRB0_SPROF_COUNTERS_2_SRC_ADDR A:0x60584160
y.create.l HWIO_SNOC_TPRB0_SPROF_COUNTERS_2_ALARMMODE_ADDR A:0x60584164
y.create.l HWIO_SNOC_TPRB0_SPROF_COUNTERS_2_VAL_ADDR A:0x60584168
y.create.l HWIO_SNOC_TPRB0_SPROF_COUNTERS_3_SRC_ADDR A:0x60584174
y.create.l HWIO_SNOC_TPRB0_SPROF_COUNTERS_3_ALARMMODE_ADDR A:0x60584178
y.create.l HWIO_SNOC_TPRB0_SPROF_COUNTERS_3_VAL_ADDR A:0x6058417c
y.create.l HWIO_SNOC_TPRB0_SPROF_COUNTERS_4_SRC_ADDR A:0x60584188
y.create.l HWIO_SNOC_TPRB0_SPROF_COUNTERS_4_ALARMMODE_ADDR A:0x6058418c
y.create.l HWIO_SNOC_TPRB0_SPROF_COUNTERS_4_VAL_ADDR A:0x60584190
y.create.l HWIO_SNOC_TPRB0_SPROF_COUNTERS_5_SRC_ADDR A:0x6058419c
y.create.l HWIO_SNOC_TPRB0_SPROF_COUNTERS_5_ALARMMODE_ADDR A:0x605841a0
y.create.l HWIO_SNOC_TPRB0_SPROF_COUNTERS_5_VAL_ADDR A:0x605841a4
y.create.l HWIO_SNOC_TPRB0_SPROF_COUNTERS_6_SRC_ADDR A:0x605841b0
y.create.l HWIO_SNOC_TPRB0_SPROF_COUNTERS_6_ALARMMODE_ADDR A:0x605841b4
y.create.l HWIO_SNOC_TPRB0_SPROF_COUNTERS_6_VAL_ADDR A:0x605841b8
y.create.l HWIO_SNOC_TPRB0_SPROF_COUNTERS_7_SRC_ADDR A:0x605841c4
y.create.l HWIO_SNOC_TPRB0_SPROF_COUNTERS_7_ALARMMODE_ADDR A:0x605841c8
y.create.l HWIO_SNOC_TPRB0_SPROF_COUNTERS_7_VAL_ADDR A:0x605841cc
y.create.l HWIO_SNOC_TPRB0_SPROF_COUNTERS_8_SRC_ADDR A:0x605841d8
y.create.l HWIO_SNOC_TPRB0_SPROF_COUNTERS_8_ALARMMODE_ADDR A:0x605841dc
y.create.l HWIO_SNOC_TPRB0_SPROF_COUNTERS_8_VAL_ADDR A:0x605841e0
y.create.l HWIO_SNOC_TPRB0_SPROF_COUNTERS_9_SRC_ADDR A:0x605841ec
y.create.l HWIO_SNOC_TPRB0_SPROF_COUNTERS_9_ALARMMODE_ADDR A:0x605841f0
y.create.l HWIO_SNOC_TPRB0_SPROF_COUNTERS_9_VAL_ADDR A:0x605841f4
y.create.l HWIO_SNOC_TPRB0_SPROF_COUNTERS_10_SRC_ADDR A:0x60584200
y.create.l HWIO_SNOC_TPRB0_SPROF_COUNTERS_10_ALARMMODE_ADDR A:0x60584204
y.create.l HWIO_SNOC_TPRB0_SPROF_COUNTERS_10_VAL_ADDR A:0x60584208
y.create.l HWIO_SNOC_TPRB0_SPROF_COUNTERS_11_SRC_ADDR A:0x60584214
y.create.l HWIO_SNOC_TPRB0_SPROF_COUNTERS_11_ALARMMODE_ADDR A:0x60584218
y.create.l HWIO_SNOC_TPRB0_SPROF_COUNTERS_11_VAL_ADDR A:0x6058421c
y.create.l HWIO_SNOC_TPRB0_SPROF_COUNTERS_12_SRC_ADDR A:0x60584228
y.create.l HWIO_SNOC_TPRB0_SPROF_COUNTERS_12_ALARMMODE_ADDR A:0x6058422c
y.create.l HWIO_SNOC_TPRB0_SPROF_COUNTERS_12_VAL_ADDR A:0x60584230
y.create.l HWIO_SNOC_TPRB0_SPROF_COUNTERS_13_SRC_ADDR A:0x6058423c
y.create.l HWIO_SNOC_TPRB0_SPROF_COUNTERS_13_ALARMMODE_ADDR A:0x60584240
y.create.l HWIO_SNOC_TPRB0_SPROF_COUNTERS_13_VAL_ADDR A:0x60584244
y.create.l HWIO_SNOC_TPRB0_SPROF_COUNTERS_14_SRC_ADDR A:0x60584250
y.create.l HWIO_SNOC_TPRB0_SPROF_COUNTERS_14_ALARMMODE_ADDR A:0x60584254
y.create.l HWIO_SNOC_TPRB0_SPROF_COUNTERS_14_VAL_ADDR A:0x60584258
y.create.l HWIO_SNOC_TPRB0_SPROF_COUNTERS_15_SRC_ADDR A:0x60584264
y.create.l HWIO_SNOC_TPRB0_SPROF_COUNTERS_15_ALARMMODE_ADDR A:0x60584268
y.create.l HWIO_SNOC_TPRB0_SPROF_COUNTERS_15_VAL_ADDR A:0x6058426c
y.create.l HWIO_SNOC_TPRB1_SPROF_ID_COREID_ADDR A:0x60584400
y.create.l HWIO_SNOC_TPRB1_SPROF_ID_REVISIONID_ADDR A:0x60584404
y.create.l HWIO_SNOC_TPRB1_SPROF_MAINCTL_ADDR A:0x60584408
y.create.l HWIO_SNOC_TPRB1_SPROF_CFGCTL_ADDR A:0x6058440c
y.create.l HWIO_SNOC_TPRB1_SPROF_STATPERIOD_ADDR A:0x60584424
y.create.l HWIO_SNOC_TPRB1_SPROF_STATGO_ADDR A:0x60584428
y.create.l HWIO_SNOC_TPRB1_SPROF_STATALARMMIN_ADDR A:0x6058442c
y.create.l HWIO_SNOC_TPRB1_SPROF_STATALARMMAX_ADDR A:0x60584430
y.create.l HWIO_SNOC_TPRB1_SPROF_STATALARMSTATUS_ADDR A:0x60584434
y.create.l HWIO_SNOC_TPRB1_SPROF_STATALARMCLR_ADDR A:0x60584438
y.create.l HWIO_SNOC_TPRB1_SPROF_COUNTERS_0_SRC_ADDR A:0x60584538
y.create.l HWIO_SNOC_TPRB1_SPROF_COUNTERS_0_ALARMMODE_ADDR A:0x6058453c
y.create.l HWIO_SNOC_TPRB1_SPROF_COUNTERS_0_VAL_ADDR A:0x60584540
y.create.l HWIO_SNOC_TPRB1_SPROF_COUNTERS_1_SRC_ADDR A:0x6058454c
y.create.l HWIO_SNOC_TPRB1_SPROF_COUNTERS_1_ALARMMODE_ADDR A:0x60584550
y.create.l HWIO_SNOC_TPRB1_SPROF_COUNTERS_1_VAL_ADDR A:0x60584554
y.create.l HWIO_SNOC_TPRB1_SPROF_COUNTERS_2_SRC_ADDR A:0x60584560
y.create.l HWIO_SNOC_TPRB1_SPROF_COUNTERS_2_ALARMMODE_ADDR A:0x60584564
y.create.l HWIO_SNOC_TPRB1_SPROF_COUNTERS_2_VAL_ADDR A:0x60584568
y.create.l HWIO_SNOC_TPRB1_SPROF_COUNTERS_3_SRC_ADDR A:0x60584574
y.create.l HWIO_SNOC_TPRB1_SPROF_COUNTERS_3_ALARMMODE_ADDR A:0x60584578
y.create.l HWIO_SNOC_TPRB1_SPROF_COUNTERS_3_VAL_ADDR A:0x6058457c
y.create.l HWIO_SNOC_TPRB1_SPROF_COUNTERS_4_SRC_ADDR A:0x60584588
y.create.l HWIO_SNOC_TPRB1_SPROF_COUNTERS_4_ALARMMODE_ADDR A:0x6058458c
y.create.l HWIO_SNOC_TPRB1_SPROF_COUNTERS_4_VAL_ADDR A:0x60584590
y.create.l HWIO_SNOC_TPRB1_SPROF_COUNTERS_5_SRC_ADDR A:0x6058459c
y.create.l HWIO_SNOC_TPRB1_SPROF_COUNTERS_5_ALARMMODE_ADDR A:0x605845a0
y.create.l HWIO_SNOC_TPRB1_SPROF_COUNTERS_5_VAL_ADDR A:0x605845a4
y.create.l HWIO_SNOC_TPRB1_SPROF_COUNTERS_6_SRC_ADDR A:0x605845b0
y.create.l HWIO_SNOC_TPRB1_SPROF_COUNTERS_6_ALARMMODE_ADDR A:0x605845b4
y.create.l HWIO_SNOC_TPRB1_SPROF_COUNTERS_6_VAL_ADDR A:0x605845b8
y.create.l HWIO_SNOC_TPRB1_SPROF_COUNTERS_7_SRC_ADDR A:0x605845c4
y.create.l HWIO_SNOC_TPRB1_SPROF_COUNTERS_7_ALARMMODE_ADDR A:0x605845c8
y.create.l HWIO_SNOC_TPRB1_SPROF_COUNTERS_7_VAL_ADDR A:0x605845cc
y.create.l HWIO_SNOC_TPRB1_SPROF_COUNTERS_8_SRC_ADDR A:0x605845d8
y.create.l HWIO_SNOC_TPRB1_SPROF_COUNTERS_8_ALARMMODE_ADDR A:0x605845dc
y.create.l HWIO_SNOC_TPRB1_SPROF_COUNTERS_8_VAL_ADDR A:0x605845e0
y.create.l HWIO_SNOC_TPRB1_SPROF_COUNTERS_9_SRC_ADDR A:0x605845ec
y.create.l HWIO_SNOC_TPRB1_SPROF_COUNTERS_9_ALARMMODE_ADDR A:0x605845f0
y.create.l HWIO_SNOC_TPRB1_SPROF_COUNTERS_9_VAL_ADDR A:0x605845f4
y.create.l HWIO_SNOC_TPRB1_SPROF_COUNTERS_10_SRC_ADDR A:0x60584600
y.create.l HWIO_SNOC_TPRB1_SPROF_COUNTERS_10_ALARMMODE_ADDR A:0x60584604
y.create.l HWIO_SNOC_TPRB1_SPROF_COUNTERS_10_VAL_ADDR A:0x60584608
y.create.l HWIO_SNOC_TPRB1_SPROF_COUNTERS_11_SRC_ADDR A:0x60584614
y.create.l HWIO_SNOC_TPRB1_SPROF_COUNTERS_11_ALARMMODE_ADDR A:0x60584618
y.create.l HWIO_SNOC_TPRB1_SPROF_COUNTERS_11_VAL_ADDR A:0x6058461c
y.create.l HWIO_SNOC_TPRB1_SPROF_COUNTERS_12_SRC_ADDR A:0x60584628
y.create.l HWIO_SNOC_TPRB1_SPROF_COUNTERS_12_ALARMMODE_ADDR A:0x6058462c
y.create.l HWIO_SNOC_TPRB1_SPROF_COUNTERS_12_VAL_ADDR A:0x60584630
y.create.l HWIO_SNOC_TPRB1_SPROF_COUNTERS_13_SRC_ADDR A:0x6058463c
y.create.l HWIO_SNOC_TPRB1_SPROF_COUNTERS_13_ALARMMODE_ADDR A:0x60584640
y.create.l HWIO_SNOC_TPRB1_SPROF_COUNTERS_13_VAL_ADDR A:0x60584644
y.create.l HWIO_SNOC_TPRB1_SPROF_COUNTERS_14_SRC_ADDR A:0x60584650
y.create.l HWIO_SNOC_TPRB1_SPROF_COUNTERS_14_ALARMMODE_ADDR A:0x60584654
y.create.l HWIO_SNOC_TPRB1_SPROF_COUNTERS_14_VAL_ADDR A:0x60584658
y.create.l HWIO_SNOC_TPRB1_SPROF_COUNTERS_15_SRC_ADDR A:0x60584664
y.create.l HWIO_SNOC_TPRB1_SPROF_COUNTERS_15_ALARMMODE_ADDR A:0x60584668
y.create.l HWIO_SNOC_TPRB1_SPROF_COUNTERS_15_VAL_ADDR A:0x6058466c
y.create.l HWIO_SNOC_TPRB2_SPROF_ID_COREID_ADDR A:0x60584800
y.create.l HWIO_SNOC_TPRB2_SPROF_ID_REVISIONID_ADDR A:0x60584804
y.create.l HWIO_SNOC_TPRB2_SPROF_MAINCTL_ADDR A:0x60584808
y.create.l HWIO_SNOC_TPRB2_SPROF_CFGCTL_ADDR A:0x6058480c
y.create.l HWIO_SNOC_TPRB2_SPROF_STATPERIOD_ADDR A:0x60584824
y.create.l HWIO_SNOC_TPRB2_SPROF_STATGO_ADDR A:0x60584828
y.create.l HWIO_SNOC_TPRB2_SPROF_STATALARMMIN_ADDR A:0x6058482c
y.create.l HWIO_SNOC_TPRB2_SPROF_STATALARMMAX_ADDR A:0x60584830
y.create.l HWIO_SNOC_TPRB2_SPROF_STATALARMSTATUS_ADDR A:0x60584834
y.create.l HWIO_SNOC_TPRB2_SPROF_STATALARMCLR_ADDR A:0x60584838
y.create.l HWIO_SNOC_TPRB2_SPROF_COUNTERS_0_SRC_ADDR A:0x60584938
y.create.l HWIO_SNOC_TPRB2_SPROF_COUNTERS_0_ALARMMODE_ADDR A:0x6058493c
y.create.l HWIO_SNOC_TPRB2_SPROF_COUNTERS_0_VAL_ADDR A:0x60584940
y.create.l HWIO_SNOC_TPRB2_SPROF_COUNTERS_1_SRC_ADDR A:0x6058494c
y.create.l HWIO_SNOC_TPRB2_SPROF_COUNTERS_1_ALARMMODE_ADDR A:0x60584950
y.create.l HWIO_SNOC_TPRB2_SPROF_COUNTERS_1_VAL_ADDR A:0x60584954
y.create.l HWIO_SNOC_TPRB2_SPROF_COUNTERS_2_SRC_ADDR A:0x60584960
y.create.l HWIO_SNOC_TPRB2_SPROF_COUNTERS_2_ALARMMODE_ADDR A:0x60584964
y.create.l HWIO_SNOC_TPRB2_SPROF_COUNTERS_2_VAL_ADDR A:0x60584968
y.create.l HWIO_SNOC_TPRB2_SPROF_COUNTERS_3_SRC_ADDR A:0x60584974
y.create.l HWIO_SNOC_TPRB2_SPROF_COUNTERS_3_ALARMMODE_ADDR A:0x60584978
y.create.l HWIO_SNOC_TPRB2_SPROF_COUNTERS_3_VAL_ADDR A:0x6058497c
y.create.l HWIO_SNOC_TPRB2_SPROF_COUNTERS_4_SRC_ADDR A:0x60584988
y.create.l HWIO_SNOC_TPRB2_SPROF_COUNTERS_4_ALARMMODE_ADDR A:0x6058498c
y.create.l HWIO_SNOC_TPRB2_SPROF_COUNTERS_4_VAL_ADDR A:0x60584990
y.create.l HWIO_SNOC_TPRB2_SPROF_COUNTERS_5_SRC_ADDR A:0x6058499c
y.create.l HWIO_SNOC_TPRB2_SPROF_COUNTERS_5_ALARMMODE_ADDR A:0x605849a0
y.create.l HWIO_SNOC_TPRB2_SPROF_COUNTERS_5_VAL_ADDR A:0x605849a4
y.create.l HWIO_SNOC_TPRB2_SPROF_COUNTERS_6_SRC_ADDR A:0x605849b0
y.create.l HWIO_SNOC_TPRB2_SPROF_COUNTERS_6_ALARMMODE_ADDR A:0x605849b4
y.create.l HWIO_SNOC_TPRB2_SPROF_COUNTERS_6_VAL_ADDR A:0x605849b8
y.create.l HWIO_SNOC_TPRB2_SPROF_COUNTERS_7_SRC_ADDR A:0x605849c4
y.create.l HWIO_SNOC_TPRB2_SPROF_COUNTERS_7_ALARMMODE_ADDR A:0x605849c8
y.create.l HWIO_SNOC_TPRB2_SPROF_COUNTERS_7_VAL_ADDR A:0x605849cc
y.create.l HWIO_SNOC_TPRB2_SPROF_COUNTERS_8_SRC_ADDR A:0x605849d8
y.create.l HWIO_SNOC_TPRB2_SPROF_COUNTERS_8_ALARMMODE_ADDR A:0x605849dc
y.create.l HWIO_SNOC_TPRB2_SPROF_COUNTERS_8_VAL_ADDR A:0x605849e0
y.create.l HWIO_SNOC_TPRB2_SPROF_COUNTERS_9_SRC_ADDR A:0x605849ec
y.create.l HWIO_SNOC_TPRB2_SPROF_COUNTERS_9_ALARMMODE_ADDR A:0x605849f0
y.create.l HWIO_SNOC_TPRB2_SPROF_COUNTERS_9_VAL_ADDR A:0x605849f4
y.create.l HWIO_SNOC_TPRB2_SPROF_COUNTERS_10_SRC_ADDR A:0x60584a00
y.create.l HWIO_SNOC_TPRB2_SPROF_COUNTERS_10_ALARMMODE_ADDR A:0x60584a04
y.create.l HWIO_SNOC_TPRB2_SPROF_COUNTERS_10_VAL_ADDR A:0x60584a08
y.create.l HWIO_SNOC_TPRB2_SPROF_COUNTERS_11_SRC_ADDR A:0x60584a14
y.create.l HWIO_SNOC_TPRB2_SPROF_COUNTERS_11_ALARMMODE_ADDR A:0x60584a18
y.create.l HWIO_SNOC_TPRB2_SPROF_COUNTERS_11_VAL_ADDR A:0x60584a1c
y.create.l HWIO_SNOC_TPRB2_SPROF_COUNTERS_12_SRC_ADDR A:0x60584a28
y.create.l HWIO_SNOC_TPRB2_SPROF_COUNTERS_12_ALARMMODE_ADDR A:0x60584a2c
y.create.l HWIO_SNOC_TPRB2_SPROF_COUNTERS_12_VAL_ADDR A:0x60584a30
y.create.l HWIO_SNOC_TPRB2_SPROF_COUNTERS_13_SRC_ADDR A:0x60584a3c
y.create.l HWIO_SNOC_TPRB2_SPROF_COUNTERS_13_ALARMMODE_ADDR A:0x60584a40
y.create.l HWIO_SNOC_TPRB2_SPROF_COUNTERS_13_VAL_ADDR A:0x60584a44
y.create.l HWIO_SNOC_TPRB2_SPROF_COUNTERS_14_SRC_ADDR A:0x60584a50
y.create.l HWIO_SNOC_TPRB2_SPROF_COUNTERS_14_ALARMMODE_ADDR A:0x60584a54
y.create.l HWIO_SNOC_TPRB2_SPROF_COUNTERS_14_VAL_ADDR A:0x60584a58
y.create.l HWIO_SNOC_TPRB2_SPROF_COUNTERS_15_SRC_ADDR A:0x60584a64
y.create.l HWIO_SNOC_TPRB2_SPROF_COUNTERS_15_ALARMMODE_ADDR A:0x60584a68
y.create.l HWIO_SNOC_TPRB2_SPROF_COUNTERS_15_VAL_ADDR A:0x60584a6c
y.create.l HWIO_SNOC_MSS_CRYPTO_NAV_DBG_QOS_ID_COREID_ADDR A:0x60588000
y.create.l HWIO_SNOC_MSS_CRYPTO_NAV_DBG_QOS_ID_REVISIONID_ADDR A:0x60588004
y.create.l HWIO_SNOC_MSS_CRYPTO_NAV_DBG_QOS_PRIORITY_ADDR A:0x60588008
y.create.l HWIO_SNOC_MSS_CRYPTO_NAV_DBG_QOS_MODE_ADDR A:0x6058800c
y.create.l HWIO_SNOC_MSS_CRYPTO_NAV_DBG_QOS_EXTCONTROL_ADDR A:0x60588018
y.create.l HWIO_SNOC_PCNOC_QOS_ID_COREID_ADDR A:0x6058c000
y.create.l HWIO_SNOC_PCNOC_QOS_ID_REVISIONID_ADDR A:0x6058c004
y.create.l HWIO_SNOC_PCNOC_QOS_PRIORITY_ADDR A:0x6058c008
y.create.l HWIO_SNOC_PCNOC_QOS_MODE_ADDR A:0x6058c00c
y.create.l HWIO_SNOC_PCNOC_QOS_EXTCONTROL_ADDR A:0x6058c018
y.create.l HWIO_SNOC_IPA_QOS_ID_COREID_ADDR A:0x6058d000
y.create.l HWIO_SNOC_IPA_QOS_ID_REVISIONID_ADDR A:0x6058d004
y.create.l HWIO_SNOC_IPA_QOS_PRIORITY_ADDR A:0x6058d008
y.create.l HWIO_SNOC_IPA_QOS_MODE_ADDR A:0x6058d00c
y.create.l HWIO_SNOC_IPA_QOS_EXTCONTROL_ADDR A:0x6058d018
y.create.l HWIO_SNOC_PCIE_QOS_ID_COREID_ADDR A:0x6058e000
y.create.l HWIO_SNOC_PCIE_QOS_ID_REVISIONID_ADDR A:0x6058e004
y.create.l HWIO_SNOC_PCIE_QOS_PRIORITY_ADDR A:0x6058e008
y.create.l HWIO_SNOC_PCIE_QOS_MODE_ADDR A:0x6058e00c
y.create.l HWIO_SNOC_PCIE_QOS_EXTCONTROL_ADDR A:0x6058e018
y.create.l HWIO_SNOC_USB3_QOS_ID_COREID_ADDR A:0x6058f000
y.create.l HWIO_SNOC_USB3_QOS_ID_REVISIONID_ADDR A:0x6058f004
y.create.l HWIO_SNOC_USB3_QOS_PRIORITY_ADDR A:0x6058f008
y.create.l HWIO_SNOC_USB3_QOS_MODE_ADDR A:0x6058f00c
y.create.l HWIO_SNOC_USB3_QOS_EXTCONTROL_ADDR A:0x6058f018
y.create.l HWIO_SNOC_QDSS_ETR_QOS_ID_COREID_ADDR A:0x60592000
y.create.l HWIO_SNOC_QDSS_ETR_QOS_ID_REVISIONID_ADDR A:0x60592004
y.create.l HWIO_SNOC_QDSS_ETR_QOS_PRIORITY_ADDR A:0x60592008
y.create.l HWIO_SNOC_QDSS_ETR_QOS_MODE_ADDR A:0x6059200c
y.create.l HWIO_SNOC_QDSS_ETR_QOS_EXTCONTROL_ADDR A:0x60592018
y.create.l HWIO_SNOC_QDSS_BAM_QOS_ID_COREID_ADDR A:0x60593000
y.create.l HWIO_SNOC_QDSS_BAM_QOS_ID_REVISIONID_ADDR A:0x60593004
y.create.l HWIO_SNOC_QDSS_BAM_QOS_PRIORITY_ADDR A:0x60593008
y.create.l HWIO_SNOC_QDSS_BAM_QOS_MODE_ADDR A:0x6059300c
y.create.l HWIO_SNOC_QDSS_BAM_QOS_EXTCONTROL_ADDR A:0x60593018
y.create.l HWIO_TCU_APPS_SMMU_SCR0_APPS_ADDR A:0x61e00000
y.create.l HWIO_TCU_APPS_SMMU_NSCR0_APPS_ADDR A:0x61e00400
y.create.l HWIO_TCU_APPS_SMMU_SCR1_APPS_ADDR A:0x61e00004
y.create.l HWIO_TCU_APPS_SMMU_SACR_APPS_ADDR A:0x61e00010
y.create.l HWIO_TCU_APPS_SMMU_NSACR_APPS_ADDR A:0x61e00410
y.create.l HWIO_TCU_APPS_SMMU_SIDR0_APPS_ADDR A:0x61e00020
y.create.l HWIO_TCU_APPS_SMMU_SIDR1_APPS_ADDR A:0x61e00024
y.create.l HWIO_TCU_APPS_SMMU_SIDR2_APPS_ADDR A:0x61e00028
y.create.l HWIO_TCU_APPS_SMMU_SIDR7_APPS_ADDR A:0x61e0003c
y.create.l HWIO_TCU_APPS_SMMU_SGFAR_LOW_APPS_ADDR A:0x61e00040
y.create.l HWIO_TCU_APPS_SMMU_SGFAR_HIGH_APPS_ADDR A:0x61e00044
y.create.l HWIO_TCU_APPS_SMMU_NSGFAR_LOW_APPS_ADDR A:0x61e00440
y.create.l HWIO_TCU_APPS_SMMU_NSGFAR_HIGH_APPS_ADDR A:0x61e00444
y.create.l HWIO_TCU_APPS_SMMU_SGFSR_APPS_ADDR A:0x61e00048
y.create.l HWIO_TCU_APPS_SMMU_NSGFSR_APPS_ADDR A:0x61e00448
y.create.l HWIO_TCU_APPS_SMMU_SGFSRRESTORE_APPS_ADDR A:0x61e0004c
y.create.l HWIO_TCU_APPS_SMMU_NSGFSRRESTORE_APPS_ADDR A:0x61e0044c
y.create.l HWIO_TCU_APPS_SMMU_SGFSYNR0_APPS_ADDR A:0x61e00050
y.create.l HWIO_TCU_APPS_SMMU_NSGFSYNR0_APPS_ADDR A:0x61e00450
y.create.l HWIO_TCU_APPS_SMMU_SGFSYNR1_APPS_ADDR A:0x61e00054
y.create.l HWIO_TCU_APPS_SMMU_NSGFSYNDR1_APPS_ADDR A:0x61e00454
y.create.l HWIO_TCU_APPS_SMMU_STLBIALL_APPS_ADDR A:0x61e00060
y.create.l HWIO_TCU_APPS_SMMU_TLBIVMID_APPS_ADDR A:0x61e00064
y.create.l HWIO_TCU_APPS_SMMU_TLBIALLNSNH_APPS_ADDR A:0x61e00068
y.create.l HWIO_TCU_APPS_SMMU_NSTLBGSYNC_APPS_ADDR A:0x61e00470
y.create.l HWIO_TCU_APPS_SMMU_STLBGSYNC_APPS_ADDR A:0x61e00070
y.create.l HWIO_TCU_APPS_SMMU_STLBGSTATUS_APPS_ADDR A:0x61e00074
y.create.l HWIO_TCU_APPS_SMMU_NSTLBGSTATUS_APPS_ADDR A:0x61e00474
y.create.l HWIO_TCU_APPS_SMMU_DBGRPTRTBU_APPS_ADDR A:0x61e00080
y.create.l HWIO_TCU_APPS_SMMU_DBGRDATATBU_APPS_ADDR A:0x61e00084
y.create.l HWIO_TCU_APPS_SMMU_DBGRPTRTCU_APPS_ADDR A:0x61e00088
y.create.l HWIO_TCU_APPS_SMMU_DBGRDATATCU_APPS_ADDR A:0x61e0008c
y.create.l HWIO_TCU_APPS_SMMU_STLBIVALM_LOW_APPS_ADDR A:0x61e000a0
y.create.l HWIO_TCU_APPS_SMMU_STLBIVALM_HIGH_APPS_ADDR A:0x61e000a4
y.create.l HWIO_TCU_APPS_SMMU_STLBIVAM_LOW_APPS_ADDR A:0x61e000a8
y.create.l HWIO_TCU_APPS_SMMU_STLBIVAM_HIGH_APPS_ADDR A:0x61e000ac
y.create.l HWIO_TCU_APPS_SMMU_STLBIALLM_APPS_ADDR A:0x61e000bc
y.create.l HWIO_TCU_APPS_SMMU_SMR0_APPS_ADDR A:0x61e00800
y.create.l HWIO_TCU_APPS_SMMU_SMR1_APPS_ADDR A:0x61e00804
y.create.l HWIO_TCU_APPS_SMMU_SMR2_APPS_ADDR A:0x61e00808
y.create.l HWIO_TCU_APPS_SMMU_SMR3_APPS_ADDR A:0x61e0080c
y.create.l HWIO_TCU_APPS_SMMU_SMR4_APPS_ADDR A:0x61e00810
y.create.l HWIO_TCU_APPS_SMMU_SMR5_APPS_ADDR A:0x61e00814
y.create.l HWIO_TCU_APPS_SMMU_SMR6_APPS_ADDR A:0x61e00818
y.create.l HWIO_TCU_APPS_SMMU_SMR7_APPS_ADDR A:0x61e0081c
y.create.l HWIO_TCU_APPS_SMMU_SMR8_APPS_ADDR A:0x61e00820
y.create.l HWIO_TCU_APPS_SMMU_SMR9_APPS_ADDR A:0x61e00824
y.create.l HWIO_TCU_APPS_SMMU_SMR10_APPS_ADDR A:0x61e00828
y.create.l HWIO_TCU_APPS_SMMU_SMR11_APPS_ADDR A:0x61e0082c
y.create.l HWIO_TCU_APPS_SMMU_SMR12_APPS_ADDR A:0x61e00830
y.create.l HWIO_TCU_APPS_SMMU_SMR13_APPS_ADDR A:0x61e00834
y.create.l HWIO_TCU_APPS_SMMU_SMR14_APPS_ADDR A:0x61e00838
y.create.l HWIO_TCU_APPS_SMMU_SMR15_APPS_ADDR A:0x61e0083c
y.create.l HWIO_TCU_APPS_SMMU_SMR16_APPS_ADDR A:0x61e00840
y.create.l HWIO_TCU_APPS_SMMU_SMR17_APPS_ADDR A:0x61e00844
y.create.l HWIO_TCU_APPS_SMMU_SMR18_APPS_ADDR A:0x61e00848
y.create.l HWIO_TCU_APPS_SMMU_SMR19_APPS_ADDR A:0x61e0084c
y.create.l HWIO_TCU_APPS_SMMU_SMR20_APPS_ADDR A:0x61e00850
y.create.l HWIO_TCU_APPS_SMMU_SMR21_APPS_ADDR A:0x61e00854
y.create.l HWIO_TCU_APPS_SMMU_SMR22_APPS_ADDR A:0x61e00858
y.create.l HWIO_TCU_APPS_SMMU_SMR23_APPS_ADDR A:0x61e0085c
y.create.l HWIO_TCU_APPS_SMMU_SMR24_APPS_ADDR A:0x61e00860
y.create.l HWIO_TCU_APPS_SMMU_SMR25_APPS_ADDR A:0x61e00864
y.create.l HWIO_TCU_APPS_SMMU_SMR26_APPS_ADDR A:0x61e00868
y.create.l HWIO_TCU_APPS_SMMU_SMR27_APPS_ADDR A:0x61e0086c
y.create.l HWIO_TCU_APPS_SMMU_SMR28_APPS_ADDR A:0x61e00870
y.create.l HWIO_TCU_APPS_SMMU_SMR29_APPS_ADDR A:0x61e00874
y.create.l HWIO_TCU_APPS_SMMU_SMR30_APPS_ADDR A:0x61e00878
y.create.l HWIO_TCU_APPS_SMMU_SMR31_APPS_ADDR A:0x61e0087c
y.create.l HWIO_TCU_APPS_SMMU_S2CR0_APPS_ADDR A:0x61e00c00
y.create.l HWIO_TCU_APPS_SMMU_S2CR1_APPS_ADDR A:0x61e00c04
y.create.l HWIO_TCU_APPS_SMMU_S2CR2_APPS_ADDR A:0x61e00c08
y.create.l HWIO_TCU_APPS_SMMU_S2CR3_APPS_ADDR A:0x61e00c0c
y.create.l HWIO_TCU_APPS_SMMU_S2CR4_APPS_ADDR A:0x61e00c10
y.create.l HWIO_TCU_APPS_SMMU_S2CR5_APPS_ADDR A:0x61e00c14
y.create.l HWIO_TCU_APPS_SMMU_S2CR6_APPS_ADDR A:0x61e00c18
y.create.l HWIO_TCU_APPS_SMMU_S2CR7_APPS_ADDR A:0x61e00c1c
y.create.l HWIO_TCU_APPS_SMMU_S2CR8_APPS_ADDR A:0x61e00c20
y.create.l HWIO_TCU_APPS_SMMU_S2CR9_APPS_ADDR A:0x61e00c24
y.create.l HWIO_TCU_APPS_SMMU_S2CR10_APPS_ADDR A:0x61e00c28
y.create.l HWIO_TCU_APPS_SMMU_S2CR11_APPS_ADDR A:0x61e00c2c
y.create.l HWIO_TCU_APPS_SMMU_S2CR12_APPS_ADDR A:0x61e00c30
y.create.l HWIO_TCU_APPS_SMMU_S2CR13_APPS_ADDR A:0x61e00c34
y.create.l HWIO_TCU_APPS_SMMU_S2CR14_APPS_ADDR A:0x61e00c38
y.create.l HWIO_TCU_APPS_SMMU_S2CR15_APPS_ADDR A:0x61e00c3c
y.create.l HWIO_TCU_APPS_SMMU_S2CR16_APPS_ADDR A:0x61e00c40
y.create.l HWIO_TCU_APPS_SMMU_S2CR17_APPS_ADDR A:0x61e00c44
y.create.l HWIO_TCU_APPS_SMMU_S2CR18_APPS_ADDR A:0x61e00c48
y.create.l HWIO_TCU_APPS_SMMU_S2CR19_APPS_ADDR A:0x61e00c4c
y.create.l HWIO_TCU_APPS_SMMU_S2CR20_APPS_ADDR A:0x61e00c50
y.create.l HWIO_TCU_APPS_SMMU_S2CR21_APPS_ADDR A:0x61e00c54
y.create.l HWIO_TCU_APPS_SMMU_S2CR22_APPS_ADDR A:0x61e00c58
y.create.l HWIO_TCU_APPS_SMMU_S2CR23_APPS_ADDR A:0x61e00c5c
y.create.l HWIO_TCU_APPS_SMMU_S2CR24_APPS_ADDR A:0x61e00c60
y.create.l HWIO_TCU_APPS_SMMU_S2CR25_APPS_ADDR A:0x61e00c64
y.create.l HWIO_TCU_APPS_SMMU_S2CR26_APPS_ADDR A:0x61e00c68
y.create.l HWIO_TCU_APPS_SMMU_S2CR27_APPS_ADDR A:0x61e00c6c
y.create.l HWIO_TCU_APPS_SMMU_S2CR28_APPS_ADDR A:0x61e00c70
y.create.l HWIO_TCU_APPS_SMMU_S2CR29_APPS_ADDR A:0x61e00c74
y.create.l HWIO_TCU_APPS_SMMU_S2CR30_APPS_ADDR A:0x61e00c78
y.create.l HWIO_TCU_APPS_SMMU_S2CR31_APPS_ADDR A:0x61e00c7c
y.create.l HWIO_TCU_APPS_SMMU_PIDR0_APPS_ADDR A:0x61e00fe0
y.create.l HWIO_TCU_APPS_SMMU_PIDR1_APPS_ADDR A:0x61e00fe4
y.create.l HWIO_TCU_APPS_SMMU_PIDR2_APPS_ADDR A:0x61e00fe8
y.create.l HWIO_TCU_APPS_SMMU_PIDR3_APPS_ADDR A:0x61e00fec
y.create.l HWIO_TCU_APPS_SMMU_PIDR4_APPS_ADDR A:0x61e00fd0
y.create.l HWIO_TCU_APPS_SMMU_PIDR5_APPS_ADDR A:0x61e00fd4
y.create.l HWIO_TCU_APPS_SMMU_PIDR6_APPS_ADDR A:0x61e00fd8
y.create.l HWIO_TCU_APPS_SMMU_PIDR7_APPS_ADDR A:0x61e00fdc
y.create.l HWIO_TCU_APPS_SMMU_CIDR0_APPS_ADDR A:0x61e00ff0
y.create.l HWIO_TCU_APPS_SMMU_CIDR1_APPS_ADDR A:0x61e00ff4
y.create.l HWIO_TCU_APPS_SMMU_CIDR2_APPS_ADDR A:0x61e00ff8
y.create.l HWIO_TCU_APPS_SMMU_CIDR3_APPS_ADDR A:0x61e00ffc
y.create.l HWIO_TCU_APPS_SMMU_CBAR0_APPS_ADDR A:0x61e01000
y.create.l HWIO_TCU_APPS_SMMU_CBFRSYNRA0_APPS_ADDR A:0x61e01400
y.create.l HWIO_TCU_APPS_SMMU_CBA2R0_APPS_ADDR A:0x61e01800
y.create.l HWIO_TCU_APPS_SMMU_CBAR1_APPS_ADDR A:0x61e01004
y.create.l HWIO_TCU_APPS_SMMU_CBFRSYNRA1_APPS_ADDR A:0x61e01404
y.create.l HWIO_TCU_APPS_SMMU_CBA2R1_APPS_ADDR A:0x61e01804
y.create.l HWIO_TCU_APPS_SMMU_CBAR2_APPS_ADDR A:0x61e01008
y.create.l HWIO_TCU_APPS_SMMU_CBFRSYNRA2_APPS_ADDR A:0x61e01408
y.create.l HWIO_TCU_APPS_SMMU_CBA2R2_APPS_ADDR A:0x61e01808
y.create.l HWIO_TCU_APPS_SMMU_CBAR3_APPS_ADDR A:0x61e0100c
y.create.l HWIO_TCU_APPS_SMMU_CBFRSYNRA3_APPS_ADDR A:0x61e0140c
y.create.l HWIO_TCU_APPS_SMMU_CBA2R3_APPS_ADDR A:0x61e0180c
y.create.l HWIO_TCU_APPS_SMMU_CBAR4_APPS_ADDR A:0x61e01010
y.create.l HWIO_TCU_APPS_SMMU_CBFRSYNRA4_APPS_ADDR A:0x61e01410
y.create.l HWIO_TCU_APPS_SMMU_CBA2R4_APPS_ADDR A:0x61e01810
y.create.l HWIO_TCU_APPS_SMMU_CBAR5_APPS_ADDR A:0x61e01014
y.create.l HWIO_TCU_APPS_SMMU_CBFRSYNRA5_APPS_ADDR A:0x61e01414
y.create.l HWIO_TCU_APPS_SMMU_CBA2R5_APPS_ADDR A:0x61e01814
y.create.l HWIO_TCU_APPS_SMMU_CBAR6_APPS_ADDR A:0x61e01018
y.create.l HWIO_TCU_APPS_SMMU_CBFRSYNRA6_APPS_ADDR A:0x61e01418
y.create.l HWIO_TCU_APPS_SMMU_CBA2R6_APPS_ADDR A:0x61e01818
y.create.l HWIO_TCU_APPS_SMMU_CBAR7_APPS_ADDR A:0x61e0101c
y.create.l HWIO_TCU_APPS_SMMU_CBFRSYNRA7_APPS_ADDR A:0x61e0141c
y.create.l HWIO_TCU_APPS_SMMU_CBA2R7_APPS_ADDR A:0x61e0181c
y.create.l HWIO_TCU_APPS_SMMU_CBAR8_APPS_ADDR A:0x61e01020
y.create.l HWIO_TCU_APPS_SMMU_CBFRSYNRA8_APPS_ADDR A:0x61e01420
y.create.l HWIO_TCU_APPS_SMMU_CBA2R8_APPS_ADDR A:0x61e01820
y.create.l HWIO_TCU_APPS_SMMU_CBAR9_APPS_ADDR A:0x61e01024
y.create.l HWIO_TCU_APPS_SMMU_CBFRSYNRA9_APPS_ADDR A:0x61e01424
y.create.l HWIO_TCU_APPS_SMMU_CBA2R9_APPS_ADDR A:0x61e01824
y.create.l HWIO_TCU_APPS_SMMU_CBAR10_APPS_ADDR A:0x61e01028
y.create.l HWIO_TCU_APPS_SMMU_CBFRSYNRA10_APPS_ADDR A:0x61e01428
y.create.l HWIO_TCU_APPS_SMMU_CBA2R10_APPS_ADDR A:0x61e01828
y.create.l HWIO_TCU_APPS_SMMU_CBAR11_APPS_ADDR A:0x61e0102c
y.create.l HWIO_TCU_APPS_SMMU_CBFRSYNRA11_APPS_ADDR A:0x61e0142c
y.create.l HWIO_TCU_APPS_SMMU_CBA2R11_APPS_ADDR A:0x61e0182c
y.create.l HWIO_TCU_APPS_SMMU_CBAR12_APPS_ADDR A:0x61e01030
y.create.l HWIO_TCU_APPS_SMMU_CBFRSYNRA12_APPS_ADDR A:0x61e01430
y.create.l HWIO_TCU_APPS_SMMU_CBA2R12_APPS_ADDR A:0x61e01830
y.create.l HWIO_TCU_APPS_SMMU_CBAR13_APPS_ADDR A:0x61e01034
y.create.l HWIO_TCU_APPS_SMMU_CBFRSYNRA13_APPS_ADDR A:0x61e01434
y.create.l HWIO_TCU_APPS_SMMU_CBA2R13_APPS_ADDR A:0x61e01834
y.create.l HWIO_TCU_APPS_SMMU_CBAR14_APPS_ADDR A:0x61e01038
y.create.l HWIO_TCU_APPS_SMMU_CBFRSYNRA14_APPS_ADDR A:0x61e01438
y.create.l HWIO_TCU_APPS_SMMU_CBA2R14_APPS_ADDR A:0x61e01838
y.create.l HWIO_TCU_APPS_SMMU_CBAR15_APPS_ADDR A:0x61e0103c
y.create.l HWIO_TCU_APPS_SMMU_CBFRSYNRA15_APPS_ADDR A:0x61e0143c
y.create.l HWIO_TCU_APPS_SMMU_CBA2R15_APPS_ADDR A:0x61e0183c
y.create.l HWIO_TCU_APPS_SMMU_ITCTRL_APPS_ADDR A:0x61e02000
y.create.l HWIO_TCU_APPS_SMMU_ITIP_APPS_ADDR A:0x61e02004
y.create.l HWIO_TCU_APPS_SMMU_ITOP_GLBL_APPS_ADDR A:0x61e02008
y.create.l HWIO_TCU_APPS_SMMU_ITOP_PERF_INDEX_APPS_ADDR A:0x61e0200c
y.create.l HWIO_TCU_APPS_SMMU_ITOP_CXT0TO31_RAM0_APPS_ADDR A:0x61e02010
y.create.l HWIO_TCU_APPS_SMMU_TBUQOS0_APPS_ADDR A:0x61e02100
y.create.l HWIO_TCU_APPS_SMMU_PER_APPS_ADDR A:0x61e02200
y.create.l HWIO_TCU_APPS_SMMU_TBU_PWR_STATUS_APPS_ADDR A:0x61e02204
y.create.l HWIO_TCU_APPS_PMEVCNTR0_APPS_ADDR A:0x61e03000
y.create.l HWIO_TCU_APPS_PMEVCNTR1_APPS_ADDR A:0x61e03004
y.create.l HWIO_TCU_APPS_PMEVCNTR2_APPS_ADDR A:0x61e03008
y.create.l HWIO_TCU_APPS_PMEVCNTR3_APPS_ADDR A:0x61e0300c
y.create.l HWIO_TCU_APPS_PMEVTYPER0_APPS_ADDR A:0x61e03400
y.create.l HWIO_TCU_APPS_PMEVTYPER1_APPS_ADDR A:0x61e03404
y.create.l HWIO_TCU_APPS_PMEVTYPER2_APPS_ADDR A:0x61e03408
y.create.l HWIO_TCU_APPS_PMEVTYPER3_APPS_ADDR A:0x61e0340c
y.create.l HWIO_TCU_APPS_PMCGCR_APPS_ADDR A:0x61e03800
y.create.l HWIO_TCU_APPS_PMCGSMR_APPS_ADDR A:0x61e03a00
y.create.l HWIO_TCU_APPS_PMCNTENSET_APPS_ADDR A:0x61e03c00
y.create.l HWIO_TCU_APPS_PMCNTENCLR_APPS_ADDR A:0x61e03c20
y.create.l HWIO_TCU_APPS_PMINTENSET_APPS_ADDR A:0x61e03c40
y.create.l HWIO_TCU_APPS_PMINTENCLR_APPS_ADDR A:0x61e03c60
y.create.l HWIO_TCU_APPS_PMOVSCLR_APPS_ADDR A:0x61e03c80
y.create.l HWIO_TCU_APPS_PMOVSSET_APPS_ADDR A:0x61e03cc0
y.create.l HWIO_TCU_APPS_PMCFGR_APPS_ADDR A:0x61e03e00
y.create.l HWIO_TCU_APPS_PMCR_APPS_ADDR A:0x61e03e04
y.create.l HWIO_TCU_APPS_SMMU_PMCEID0_APPS_ADDR A:0x61e03e20
y.create.l HWIO_TCU_APPS_SMMU_PMAUTHSTATUS_APPS_ADDR A:0x61e03fb8
y.create.l HWIO_TCU_APPS_SMMU_PMDEVTYPE_APPS_ADDR A:0x61e03fcc
y.create.l HWIO_TCU_APPS_SMMU_SSD_REG_0_APPS_ADDR A:0x61e04000
y.create.l HWIO_TCU_APPS_SMMU_SSD_REG_1_APPS_ADDR A:0x61e04004
y.create.l HWIO_TCU_APPS_SMMU_SSD_REG_2_APPS_ADDR A:0x61e04008
y.create.l HWIO_TCU_APPS_SMMU_SSD_REG_3_APPS_ADDR A:0x61e0400c
y.create.l HWIO_TCU_APPS_SMMU_SSD_REG_4_APPS_ADDR A:0x61e04010
y.create.l HWIO_TCU_APPS_SMMU_SSD_REG_5_APPS_ADDR A:0x61e04014
y.create.l HWIO_TCU_APPS_SMMU_SSD_REG_6_APPS_ADDR A:0x61e04018
y.create.l HWIO_TCU_APPS_SMMU_SSD_REG_7_APPS_ADDR A:0x61e0401c
y.create.l HWIO_TCU_APPS_SMMU_SSD_REG_8_APPS_ADDR A:0x61e04020
y.create.l HWIO_TCU_APPS_SMMU_SSD_REG_9_APPS_ADDR A:0x61e04024
y.create.l HWIO_TCU_APPS_SMMU_SSD_REG_10_APPS_ADDR A:0x61e04028
y.create.l HWIO_TCU_APPS_SMMU_SSD_REG_11_APPS_ADDR A:0x61e0402c
y.create.l HWIO_TCU_APPS_SMMU_SSD_REG_12_APPS_ADDR A:0x61e04030
y.create.l HWIO_TCU_APPS_SMMU_SSD_REG_13_APPS_ADDR A:0x61e04034
y.create.l HWIO_TCU_APPS_SMMU_SSD_REG_14_APPS_ADDR A:0x61e04038
y.create.l HWIO_TCU_APPS_SMMU_SSD_REG_15_APPS_ADDR A:0x61e0403c
y.create.l HWIO_TCU_APPS_SMMU_SSD_REG_16_APPS_ADDR A:0x61e04040
y.create.l HWIO_TCU_APPS_SMMU_SSD_REG_17_APPS_ADDR A:0x61e04044
y.create.l HWIO_TCU_APPS_SMMU_SSD_REG_18_APPS_ADDR A:0x61e04048
y.create.l HWIO_TCU_APPS_SMMU_SSD_REG_19_APPS_ADDR A:0x61e0404c
y.create.l HWIO_TCU_APPS_SMMU_SSD_REG_20_APPS_ADDR A:0x61e04050
y.create.l HWIO_TCU_APPS_SMMU_SSD_REG_21_APPS_ADDR A:0x61e04054
y.create.l HWIO_TCU_APPS_SMMU_SSD_REG_22_APPS_ADDR A:0x61e04058
y.create.l HWIO_TCU_APPS_SMMU_SSD_REG_23_APPS_ADDR A:0x61e0405c
y.create.l HWIO_TCU_APPS_SMMU_SSD_REG_24_APPS_ADDR A:0x61e04060
y.create.l HWIO_TCU_APPS_SMMU_SSD_REG_25_APPS_ADDR A:0x61e04064
y.create.l HWIO_TCU_APPS_SMMU_SSD_REG_26_APPS_ADDR A:0x61e04068
y.create.l HWIO_TCU_APPS_SMMU_SSD_REG_27_APPS_ADDR A:0x61e0406c
y.create.l HWIO_TCU_APPS_SMMU_SSD_REG_28_APPS_ADDR A:0x61e04070
y.create.l HWIO_TCU_APPS_SMMU_SSD_REG_29_APPS_ADDR A:0x61e04074
y.create.l HWIO_TCU_APPS_SMMU_SSD_REG_30_APPS_ADDR A:0x61e04078
y.create.l HWIO_TCU_APPS_SMMU_SSD_REG_31_APPS_ADDR A:0x61e0407c
y.create.l HWIO_TCU_APPS_SMMU_SSD_REG_32_APPS_ADDR A:0x61e04080
y.create.l HWIO_TCU_APPS_SMMU_SSD_REG_33_APPS_ADDR A:0x61e04084
y.create.l HWIO_TCU_APPS_SMMU_SSD_REG_34_APPS_ADDR A:0x61e04088
y.create.l HWIO_TCU_APPS_SMMU_SSD_REG_35_APPS_ADDR A:0x61e0408c
y.create.l HWIO_TCU_APPS_SMMU_SSD_REG_36_APPS_ADDR A:0x61e04090
y.create.l HWIO_TCU_APPS_SMMU_SSD_REG_37_APPS_ADDR A:0x61e04094
y.create.l HWIO_TCU_APPS_SMMU_SSD_REG_38_APPS_ADDR A:0x61e04098
y.create.l HWIO_TCU_APPS_SMMU_SSD_REG_39_APPS_ADDR A:0x61e0409c
y.create.l HWIO_TCU_APPS_SMMU_SSD_REG_40_APPS_ADDR A:0x61e040a0
y.create.l HWIO_TCU_APPS_SMMU_SSD_REG_41_APPS_ADDR A:0x61e040a4
y.create.l HWIO_TCU_APPS_SMMU_SSD_REG_42_APPS_ADDR A:0x61e040a8
y.create.l HWIO_TCU_APPS_SMMU_SSD_REG_43_APPS_ADDR A:0x61e040ac
y.create.l HWIO_TCU_APPS_SMMU_SSD_REG_44_APPS_ADDR A:0x61e040b0
y.create.l HWIO_TCU_APPS_SMMU_SSD_REG_45_APPS_ADDR A:0x61e040b4
y.create.l HWIO_TCU_APPS_SMMU_SSD_REG_46_APPS_ADDR A:0x61e040b8
y.create.l HWIO_TCU_APPS_SMMU_SSD_REG_47_APPS_ADDR A:0x61e040bc
y.create.l HWIO_TCU_APPS_SMMU_SSD_REG_48_APPS_ADDR A:0x61e040c0
y.create.l HWIO_TCU_APPS_SMMU_SSD_REG_49_APPS_ADDR A:0x61e040c4
y.create.l HWIO_TCU_APPS_SMMU_SSD_REG_50_APPS_ADDR A:0x61e040c8
y.create.l HWIO_TCU_APPS_SMMU_SSD_REG_51_APPS_ADDR A:0x61e040cc
y.create.l HWIO_TCU_APPS_SMMU_SSD_REG_52_APPS_ADDR A:0x61e040d0
y.create.l HWIO_TCU_APPS_SMMU_SSD_REG_53_APPS_ADDR A:0x61e040d4
y.create.l HWIO_TCU_APPS_SMMU_SSD_REG_54_APPS_ADDR A:0x61e040d8
y.create.l HWIO_TCU_APPS_SMMU_SSD_REG_55_APPS_ADDR A:0x61e040dc
y.create.l HWIO_TCU_APPS_SMMU_SSD_REG_56_APPS_ADDR A:0x61e040e0
y.create.l HWIO_TCU_APPS_SMMU_SSD_REG_57_APPS_ADDR A:0x61e040e4
y.create.l HWIO_TCU_APPS_SMMU_SSD_REG_58_APPS_ADDR A:0x61e040e8
y.create.l HWIO_TCU_APPS_SMMU_SSD_REG_59_APPS_ADDR A:0x61e040ec
y.create.l HWIO_TCU_APPS_SMMU_SSD_REG_60_APPS_ADDR A:0x61e040f0
y.create.l HWIO_TCU_APPS_SMMU_SSD_REG_61_APPS_ADDR A:0x61e040f4
y.create.l HWIO_TCU_APPS_SMMU_SSD_REG_62_APPS_ADDR A:0x61e040f8
y.create.l HWIO_TCU_APPS_SMMU_SSD_REG_63_APPS_ADDR A:0x61e040fc
y.create.l HWIO_TCU_APPS_SMMU_SSD_REG_64_APPS_ADDR A:0x61e04100
y.create.l HWIO_TCU_APPS_SMMU_SSD_REG_65_APPS_ADDR A:0x61e04104
y.create.l HWIO_TCU_APPS_SMMU_SSD_REG_66_APPS_ADDR A:0x61e04108
y.create.l HWIO_TCU_APPS_SMMU_SSD_REG_67_APPS_ADDR A:0x61e0410c
y.create.l HWIO_TCU_APPS_SMMU_SSD_REG_68_APPS_ADDR A:0x61e04110
y.create.l HWIO_TCU_APPS_SMMU_SSD_REG_69_APPS_ADDR A:0x61e04114
y.create.l HWIO_TCU_APPS_SMMU_SSD_REG_70_APPS_ADDR A:0x61e04118
y.create.l HWIO_TCU_APPS_SMMU_SSD_REG_71_APPS_ADDR A:0x61e0411c
y.create.l HWIO_TCU_APPS_SMMU_SSD_REG_72_APPS_ADDR A:0x61e04120
y.create.l HWIO_TCU_APPS_SMMU_SSD_REG_73_APPS_ADDR A:0x61e04124
y.create.l HWIO_TCU_APPS_SMMU_SSD_REG_74_APPS_ADDR A:0x61e04128
y.create.l HWIO_TCU_APPS_SMMU_SSD_REG_75_APPS_ADDR A:0x61e0412c
y.create.l HWIO_TCU_APPS_SMMU_SSD_REG_76_APPS_ADDR A:0x61e04130
y.create.l HWIO_TCU_APPS_SMMU_SSD_REG_77_APPS_ADDR A:0x61e04134
y.create.l HWIO_TCU_APPS_SMMU_SSD_REG_78_APPS_ADDR A:0x61e04138
y.create.l HWIO_TCU_APPS_SMMU_SSD_REG_79_APPS_ADDR A:0x61e0413c
y.create.l HWIO_TCU_APPS_SMMU_SSD_REG_80_APPS_ADDR A:0x61e04140
y.create.l HWIO_TCU_APPS_SMMU_SSD_REG_81_APPS_ADDR A:0x61e04144
y.create.l HWIO_TCU_APPS_SMMU_SSD_REG_82_APPS_ADDR A:0x61e04148
y.create.l HWIO_TCU_APPS_SMMU_SSD_REG_83_APPS_ADDR A:0x61e0414c
y.create.l HWIO_TCU_APPS_SMMU_SSD_REG_84_APPS_ADDR A:0x61e04150
y.create.l HWIO_TCU_APPS_SMMU_SSD_REG_85_APPS_ADDR A:0x61e04154
y.create.l HWIO_TCU_APPS_SMMU_SSD_REG_86_APPS_ADDR A:0x61e04158
y.create.l HWIO_TCU_APPS_SMMU_SSD_REG_87_APPS_ADDR A:0x61e0415c
y.create.l HWIO_TCU_APPS_SMMU_SSD_REG_88_APPS_ADDR A:0x61e04160
y.create.l HWIO_TCU_APPS_SMMU_SSD_REG_89_APPS_ADDR A:0x61e04164
y.create.l HWIO_TCU_APPS_SMMU_SSD_REG_90_APPS_ADDR A:0x61e04168
y.create.l HWIO_TCU_APPS_SMMU_SSD_REG_91_APPS_ADDR A:0x61e0416c
y.create.l HWIO_TCU_APPS_SMMU_SSD_REG_92_APPS_ADDR A:0x61e04170
y.create.l HWIO_TCU_APPS_SMMU_SSD_REG_93_APPS_ADDR A:0x61e04174
y.create.l HWIO_TCU_APPS_SMMU_SSD_REG_94_APPS_ADDR A:0x61e04178
y.create.l HWIO_TCU_APPS_SMMU_SSD_REG_95_APPS_ADDR A:0x61e0417c
y.create.l HWIO_TCU_APPS_SMMU_SSD_REG_96_APPS_ADDR A:0x61e04180
y.create.l HWIO_TCU_APPS_SMMU_SSD_REG_97_APPS_ADDR A:0x61e04184
y.create.l HWIO_TCU_APPS_SMMU_SSD_REG_98_APPS_ADDR A:0x61e04188
y.create.l HWIO_TCU_APPS_SMMU_SSD_REG_99_APPS_ADDR A:0x61e0418c
y.create.l HWIO_TCU_APPS_SMMU_SSD_REG_100_APPS_ADDR A:0x61e04190
y.create.l HWIO_TCU_APPS_SMMU_SSD_REG_101_APPS_ADDR A:0x61e04194
y.create.l HWIO_TCU_APPS_SMMU_SSD_REG_102_APPS_ADDR A:0x61e04198
y.create.l HWIO_TCU_APPS_SMMU_SSD_REG_103_APPS_ADDR A:0x61e0419c
y.create.l HWIO_TCU_APPS_SMMU_SSD_REG_104_APPS_ADDR A:0x61e041a0
y.create.l HWIO_TCU_APPS_SMMU_SSD_REG_105_APPS_ADDR A:0x61e041a4
y.create.l HWIO_TCU_APPS_SMMU_SSD_REG_106_APPS_ADDR A:0x61e041a8
y.create.l HWIO_TCU_APPS_SMMU_SSD_REG_107_APPS_ADDR A:0x61e041ac
y.create.l HWIO_TCU_APPS_SMMU_SSD_REG_108_APPS_ADDR A:0x61e041b0
y.create.l HWIO_TCU_APPS_SMMU_SSD_REG_109_APPS_ADDR A:0x61e041b4
y.create.l HWIO_TCU_APPS_SMMU_SSD_REG_110_APPS_ADDR A:0x61e041b8
y.create.l HWIO_TCU_APPS_SMMU_SSD_REG_111_APPS_ADDR A:0x61e041bc
y.create.l HWIO_TCU_APPS_SMMU_SSD_REG_112_APPS_ADDR A:0x61e041c0
y.create.l HWIO_TCU_APPS_SMMU_SSD_REG_113_APPS_ADDR A:0x61e041c4
y.create.l HWIO_TCU_APPS_SMMU_SSD_REG_114_APPS_ADDR A:0x61e041c8
y.create.l HWIO_TCU_APPS_SMMU_SSD_REG_115_APPS_ADDR A:0x61e041cc
y.create.l HWIO_TCU_APPS_SMMU_SSD_REG_116_APPS_ADDR A:0x61e041d0
y.create.l HWIO_TCU_APPS_SMMU_SSD_REG_117_APPS_ADDR A:0x61e041d4
y.create.l HWIO_TCU_APPS_SMMU_SSD_REG_118_APPS_ADDR A:0x61e041d8
y.create.l HWIO_TCU_APPS_SMMU_SSD_REG_119_APPS_ADDR A:0x61e041dc
y.create.l HWIO_TCU_APPS_SMMU_SSD_REG_120_APPS_ADDR A:0x61e041e0
y.create.l HWIO_TCU_APPS_SMMU_SSD_REG_121_APPS_ADDR A:0x61e041e4
y.create.l HWIO_TCU_APPS_SMMU_SSD_REG_122_APPS_ADDR A:0x61e041e8
y.create.l HWIO_TCU_APPS_SMMU_SSD_REG_123_APPS_ADDR A:0x61e041ec
y.create.l HWIO_TCU_APPS_SMMU_SSD_REG_124_APPS_ADDR A:0x61e041f0
y.create.l HWIO_TCU_APPS_SMMU_SSD_REG_125_APPS_ADDR A:0x61e041f4
y.create.l HWIO_TCU_APPS_SMMU_SSD_REG_126_APPS_ADDR A:0x61e041f8
y.create.l HWIO_TCU_APPS_SMMU_SSD_REG_127_APPS_ADDR A:0x61e041fc
y.create.l HWIO_TCU_APPS_SMMU_SSD_REG_128_APPS_ADDR A:0x61e04200
y.create.l HWIO_TCU_APPS_SMMU_SSD_REG_129_APPS_ADDR A:0x61e04204
y.create.l HWIO_TCU_APPS_SMMU_SSD_REG_130_APPS_ADDR A:0x61e04208
y.create.l HWIO_TCU_APPS_SMMU_SSD_REG_131_APPS_ADDR A:0x61e0420c
y.create.l HWIO_TCU_APPS_SMMU_SSD_REG_132_APPS_ADDR A:0x61e04210
y.create.l HWIO_TCU_APPS_SMMU_SSD_REG_133_APPS_ADDR A:0x61e04214
y.create.l HWIO_TCU_APPS_SMMU_SSD_REG_134_APPS_ADDR A:0x61e04218
y.create.l HWIO_TCU_APPS_SMMU_SSD_REG_135_APPS_ADDR A:0x61e0421c
y.create.l HWIO_TCU_APPS_SMMU_SSD_REG_136_APPS_ADDR A:0x61e04220
y.create.l HWIO_TCU_APPS_SMMU_SSD_REG_137_APPS_ADDR A:0x61e04224
y.create.l HWIO_TCU_APPS_SMMU_SSD_REG_138_APPS_ADDR A:0x61e04228
y.create.l HWIO_TCU_APPS_SMMU_SSD_REG_139_APPS_ADDR A:0x61e0422c
y.create.l HWIO_TCU_APPS_SMMU_SSD_REG_140_APPS_ADDR A:0x61e04230
y.create.l HWIO_TCU_APPS_SMMU_SSD_REG_141_APPS_ADDR A:0x61e04234
y.create.l HWIO_TCU_APPS_SMMU_SSD_REG_142_APPS_ADDR A:0x61e04238
y.create.l HWIO_TCU_APPS_SMMU_SSD_REG_143_APPS_ADDR A:0x61e0423c
y.create.l HWIO_TCU_APPS_SMMU_SSD_REG_144_APPS_ADDR A:0x61e04240
y.create.l HWIO_TCU_APPS_SMMU_SSD_REG_145_APPS_ADDR A:0x61e04244
y.create.l HWIO_TCU_APPS_SMMU_SSD_REG_146_APPS_ADDR A:0x61e04248
y.create.l HWIO_TCU_APPS_SMMU_SSD_REG_147_APPS_ADDR A:0x61e0424c
y.create.l HWIO_TCU_APPS_SMMU_SSD_REG_148_APPS_ADDR A:0x61e04250
y.create.l HWIO_TCU_APPS_SMMU_SSD_REG_149_APPS_ADDR A:0x61e04254
y.create.l HWIO_TCU_APPS_SMMU_SSD_REG_150_APPS_ADDR A:0x61e04258
y.create.l HWIO_TCU_APPS_SMMU_SSD_REG_151_APPS_ADDR A:0x61e0425c
y.create.l HWIO_TCU_APPS_SMMU_SSD_REG_152_APPS_ADDR A:0x61e04260
y.create.l HWIO_TCU_APPS_SMMU_SSD_REG_153_APPS_ADDR A:0x61e04264
y.create.l HWIO_TCU_APPS_SMMU_SSD_REG_154_APPS_ADDR A:0x61e04268
y.create.l HWIO_TCU_APPS_SMMU_SSD_REG_155_APPS_ADDR A:0x61e0426c
y.create.l HWIO_TCU_APPS_SMMU_SSD_REG_156_APPS_ADDR A:0x61e04270
y.create.l HWIO_TCU_APPS_SMMU_SSD_REG_157_APPS_ADDR A:0x61e04274
y.create.l HWIO_TCU_APPS_SMMU_SSD_REG_158_APPS_ADDR A:0x61e04278
y.create.l HWIO_TCU_APPS_SMMU_SSD_REG_159_APPS_ADDR A:0x61e0427c
y.create.l HWIO_TCU_APPS_SMMU_SSD_REG_160_APPS_ADDR A:0x61e04280
y.create.l HWIO_TCU_APPS_SMMU_SSD_REG_161_APPS_ADDR A:0x61e04284
y.create.l HWIO_TCU_APPS_SMMU_SSD_REG_162_APPS_ADDR A:0x61e04288
y.create.l HWIO_TCU_APPS_SMMU_SSD_REG_163_APPS_ADDR A:0x61e0428c
y.create.l HWIO_TCU_APPS_SMMU_SSD_REG_164_APPS_ADDR A:0x61e04290
y.create.l HWIO_TCU_APPS_SMMU_SSD_REG_165_APPS_ADDR A:0x61e04294
y.create.l HWIO_TCU_APPS_SMMU_SSD_REG_166_APPS_ADDR A:0x61e04298
y.create.l HWIO_TCU_APPS_SMMU_SSD_REG_167_APPS_ADDR A:0x61e0429c
y.create.l HWIO_TCU_APPS_SMMU_SSD_REG_168_APPS_ADDR A:0x61e042a0
y.create.l HWIO_TCU_APPS_SMMU_SSD_REG_169_APPS_ADDR A:0x61e042a4
y.create.l HWIO_TCU_APPS_SMMU_SSD_REG_170_APPS_ADDR A:0x61e042a8
y.create.l HWIO_TCU_APPS_SMMU_SSD_REG_171_APPS_ADDR A:0x61e042ac
y.create.l HWIO_TCU_APPS_SMMU_SSD_REG_172_APPS_ADDR A:0x61e042b0
y.create.l HWIO_TCU_APPS_SMMU_SSD_REG_173_APPS_ADDR A:0x61e042b4
y.create.l HWIO_TCU_APPS_SMMU_SSD_REG_174_APPS_ADDR A:0x61e042b8
y.create.l HWIO_TCU_APPS_SMMU_SSD_REG_175_APPS_ADDR A:0x61e042bc
y.create.l HWIO_TCU_APPS_SMMU_SSD_REG_176_APPS_ADDR A:0x61e042c0
y.create.l HWIO_TCU_APPS_SMMU_SSD_REG_177_APPS_ADDR A:0x61e042c4
y.create.l HWIO_TCU_APPS_SMMU_SSD_REG_178_APPS_ADDR A:0x61e042c8
y.create.l HWIO_TCU_APPS_SMMU_SSD_REG_179_APPS_ADDR A:0x61e042cc
y.create.l HWIO_TCU_APPS_SMMU_SSD_REG_180_APPS_ADDR A:0x61e042d0
y.create.l HWIO_TCU_APPS_SMMU_SSD_REG_181_APPS_ADDR A:0x61e042d4
y.create.l HWIO_TCU_APPS_SMMU_SSD_REG_182_APPS_ADDR A:0x61e042d8
y.create.l HWIO_TCU_APPS_SMMU_SSD_REG_183_APPS_ADDR A:0x61e042dc
y.create.l HWIO_TCU_APPS_SMMU_SSD_REG_184_APPS_ADDR A:0x61e042e0
y.create.l HWIO_TCU_APPS_SMMU_SSD_REG_185_APPS_ADDR A:0x61e042e4
y.create.l HWIO_TCU_APPS_SMMU_SSD_REG_186_APPS_ADDR A:0x61e042e8
y.create.l HWIO_TCU_APPS_SMMU_SSD_REG_187_APPS_ADDR A:0x61e042ec
y.create.l HWIO_TCU_APPS_SMMU_SSD_REG_188_APPS_ADDR A:0x61e042f0
y.create.l HWIO_TCU_APPS_SMMU_SSD_REG_189_APPS_ADDR A:0x61e042f4
y.create.l HWIO_TCU_APPS_SMMU_SSD_REG_190_APPS_ADDR A:0x61e042f8
y.create.l HWIO_TCU_APPS_SMMU_SSD_REG_191_APPS_ADDR A:0x61e042fc
y.create.l HWIO_TCU_APPS_SMMU_SSD_REG_192_APPS_ADDR A:0x61e04300
y.create.l HWIO_TCU_APPS_SMMU_SSD_REG_193_APPS_ADDR A:0x61e04304
y.create.l HWIO_TCU_APPS_SMMU_SSD_REG_194_APPS_ADDR A:0x61e04308
y.create.l HWIO_TCU_APPS_SMMU_SSD_REG_195_APPS_ADDR A:0x61e0430c
y.create.l HWIO_TCU_APPS_SMMU_SSD_REG_196_APPS_ADDR A:0x61e04310
y.create.l HWIO_TCU_APPS_SMMU_SSD_REG_197_APPS_ADDR A:0x61e04314
y.create.l HWIO_TCU_APPS_SMMU_SSD_REG_198_APPS_ADDR A:0x61e04318
y.create.l HWIO_TCU_APPS_SMMU_SSD_REG_199_APPS_ADDR A:0x61e0431c
y.create.l HWIO_TCU_APPS_SMMU_SSD_REG_200_APPS_ADDR A:0x61e04320
y.create.l HWIO_TCU_APPS_SMMU_SSD_REG_201_APPS_ADDR A:0x61e04324
y.create.l HWIO_TCU_APPS_SMMU_SSD_REG_202_APPS_ADDR A:0x61e04328
y.create.l HWIO_TCU_APPS_SMMU_SSD_REG_203_APPS_ADDR A:0x61e0432c
y.create.l HWIO_TCU_APPS_SMMU_SSD_REG_204_APPS_ADDR A:0x61e04330
y.create.l HWIO_TCU_APPS_SMMU_SSD_REG_205_APPS_ADDR A:0x61e04334
y.create.l HWIO_TCU_APPS_SMMU_SSD_REG_206_APPS_ADDR A:0x61e04338
y.create.l HWIO_TCU_APPS_SMMU_SSD_REG_207_APPS_ADDR A:0x61e0433c
y.create.l HWIO_TCU_APPS_SMMU_SSD_REG_208_APPS_ADDR A:0x61e04340
y.create.l HWIO_TCU_APPS_SMMU_SSD_REG_209_APPS_ADDR A:0x61e04344
y.create.l HWIO_TCU_APPS_SMMU_SSD_REG_210_APPS_ADDR A:0x61e04348
y.create.l HWIO_TCU_APPS_SMMU_SSD_REG_211_APPS_ADDR A:0x61e0434c
y.create.l HWIO_TCU_APPS_SMMU_SSD_REG_212_APPS_ADDR A:0x61e04350
y.create.l HWIO_TCU_APPS_SMMU_SSD_REG_213_APPS_ADDR A:0x61e04354
y.create.l HWIO_TCU_APPS_SMMU_SSD_REG_214_APPS_ADDR A:0x61e04358
y.create.l HWIO_TCU_APPS_SMMU_SSD_REG_215_APPS_ADDR A:0x61e0435c
y.create.l HWIO_TCU_APPS_SMMU_SSD_REG_216_APPS_ADDR A:0x61e04360
y.create.l HWIO_TCU_APPS_SMMU_SSD_REG_217_APPS_ADDR A:0x61e04364
y.create.l HWIO_TCU_APPS_SMMU_SSD_REG_218_APPS_ADDR A:0x61e04368
y.create.l HWIO_TCU_APPS_SMMU_SSD_REG_219_APPS_ADDR A:0x61e0436c
y.create.l HWIO_TCU_APPS_SMMU_SSD_REG_220_APPS_ADDR A:0x61e04370
y.create.l HWIO_TCU_APPS_SMMU_SSD_REG_221_APPS_ADDR A:0x61e04374
y.create.l HWIO_TCU_APPS_SMMU_SSD_REG_222_APPS_ADDR A:0x61e04378
y.create.l HWIO_TCU_APPS_SMMU_SSD_REG_223_APPS_ADDR A:0x61e0437c
y.create.l HWIO_TCU_APPS_SMMU_SSD_REG_224_APPS_ADDR A:0x61e04380
y.create.l HWIO_TCU_APPS_SMMU_SSD_REG_225_APPS_ADDR A:0x61e04384
y.create.l HWIO_TCU_APPS_SMMU_SSD_REG_226_APPS_ADDR A:0x61e04388
y.create.l HWIO_TCU_APPS_SMMU_SSD_REG_227_APPS_ADDR A:0x61e0438c
y.create.l HWIO_TCU_APPS_SMMU_SSD_REG_228_APPS_ADDR A:0x61e04390
y.create.l HWIO_TCU_APPS_SMMU_SSD_REG_229_APPS_ADDR A:0x61e04394
y.create.l HWIO_TCU_APPS_SMMU_SSD_REG_230_APPS_ADDR A:0x61e04398
y.create.l HWIO_TCU_APPS_SMMU_SSD_REG_231_APPS_ADDR A:0x61e0439c
y.create.l HWIO_TCU_APPS_SMMU_SSD_REG_232_APPS_ADDR A:0x61e043a0
y.create.l HWIO_TCU_APPS_SMMU_SSD_REG_233_APPS_ADDR A:0x61e043a4
y.create.l HWIO_TCU_APPS_SMMU_SSD_REG_234_APPS_ADDR A:0x61e043a8
y.create.l HWIO_TCU_APPS_SMMU_SSD_REG_235_APPS_ADDR A:0x61e043ac
y.create.l HWIO_TCU_APPS_SMMU_SSD_REG_236_APPS_ADDR A:0x61e043b0
y.create.l HWIO_TCU_APPS_SMMU_SSD_REG_237_APPS_ADDR A:0x61e043b4
y.create.l HWIO_TCU_APPS_SMMU_SSD_REG_238_APPS_ADDR A:0x61e043b8
y.create.l HWIO_TCU_APPS_SMMU_SSD_REG_239_APPS_ADDR A:0x61e043bc
y.create.l HWIO_TCU_APPS_SMMU_SSD_REG_240_APPS_ADDR A:0x61e043c0
y.create.l HWIO_TCU_APPS_SMMU_SSD_REG_241_APPS_ADDR A:0x61e043c4
y.create.l HWIO_TCU_APPS_SMMU_SSD_REG_242_APPS_ADDR A:0x61e043c8
y.create.l HWIO_TCU_APPS_SMMU_SSD_REG_243_APPS_ADDR A:0x61e043cc
y.create.l HWIO_TCU_APPS_SMMU_SSD_REG_244_APPS_ADDR A:0x61e043d0
y.create.l HWIO_TCU_APPS_SMMU_SSD_REG_245_APPS_ADDR A:0x61e043d4
y.create.l HWIO_TCU_APPS_SMMU_SSD_REG_246_APPS_ADDR A:0x61e043d8
y.create.l HWIO_TCU_APPS_SMMU_SSD_REG_247_APPS_ADDR A:0x61e043dc
y.create.l HWIO_TCU_APPS_SMMU_SSD_REG_248_APPS_ADDR A:0x61e043e0
y.create.l HWIO_TCU_APPS_SMMU_SSD_REG_249_APPS_ADDR A:0x61e043e4
y.create.l HWIO_TCU_APPS_SMMU_SSD_REG_250_APPS_ADDR A:0x61e043e8
y.create.l HWIO_TCU_APPS_SMMU_SSD_REG_251_APPS_ADDR A:0x61e043ec
y.create.l HWIO_TCU_APPS_SMMU_SSD_REG_252_APPS_ADDR A:0x61e043f0
y.create.l HWIO_TCU_APPS_SMMU_SSD_REG_253_APPS_ADDR A:0x61e043f4
y.create.l HWIO_TCU_APPS_SMMU_SSD_REG_254_APPS_ADDR A:0x61e043f8
y.create.l HWIO_TCU_APPS_SMMU_SSD_REG_255_APPS_ADDR A:0x61e043fc
y.create.l HWIO_TCU_APPS_SMMU_SSD_REG_256_APPS_ADDR A:0x61e04400
y.create.l HWIO_TCU_APPS_SMMU_SSD_REG_257_APPS_ADDR A:0x61e04404
y.create.l HWIO_TCU_APPS_SMMU_SSD_REG_258_APPS_ADDR A:0x61e04408
y.create.l HWIO_TCU_APPS_SMMU_SSD_REG_259_APPS_ADDR A:0x61e0440c
y.create.l HWIO_TCU_APPS_SMMU_SSD_REG_260_APPS_ADDR A:0x61e04410
y.create.l HWIO_TCU_APPS_SMMU_SSD_REG_261_APPS_ADDR A:0x61e04414
y.create.l HWIO_TCU_APPS_SMMU_SSD_REG_262_APPS_ADDR A:0x61e04418
y.create.l HWIO_TCU_APPS_SMMU_SSD_REG_263_APPS_ADDR A:0x61e0441c
y.create.l HWIO_TCU_APPS_SMMU_SSD_REG_264_APPS_ADDR A:0x61e04420
y.create.l HWIO_TCU_APPS_SMMU_SSD_REG_265_APPS_ADDR A:0x61e04424
y.create.l HWIO_TCU_APPS_SMMU_SSD_REG_266_APPS_ADDR A:0x61e04428
y.create.l HWIO_TCU_APPS_SMMU_SSD_REG_267_APPS_ADDR A:0x61e0442c
y.create.l HWIO_TCU_APPS_SMMU_SSD_REG_268_APPS_ADDR A:0x61e04430
y.create.l HWIO_TCU_APPS_SMMU_SSD_REG_269_APPS_ADDR A:0x61e04434
y.create.l HWIO_TCU_APPS_SMMU_SSD_REG_270_APPS_ADDR A:0x61e04438
y.create.l HWIO_TCU_APPS_SMMU_SSD_REG_271_APPS_ADDR A:0x61e0443c
y.create.l HWIO_TCU_APPS_SMMU_SSD_REG_272_APPS_ADDR A:0x61e04440
y.create.l HWIO_TCU_APPS_SMMU_SSD_REG_273_APPS_ADDR A:0x61e04444
y.create.l HWIO_TCU_APPS_SMMU_SSD_REG_274_APPS_ADDR A:0x61e04448
y.create.l HWIO_TCU_APPS_SMMU_SSD_REG_275_APPS_ADDR A:0x61e0444c
y.create.l HWIO_TCU_APPS_SMMU_SSD_REG_276_APPS_ADDR A:0x61e04450
y.create.l HWIO_TCU_APPS_SMMU_SSD_REG_277_APPS_ADDR A:0x61e04454
y.create.l HWIO_TCU_APPS_SMMU_SSD_REG_278_APPS_ADDR A:0x61e04458
y.create.l HWIO_TCU_APPS_SMMU_SSD_REG_279_APPS_ADDR A:0x61e0445c
y.create.l HWIO_TCU_APPS_SMMU_SSD_REG_280_APPS_ADDR A:0x61e04460
y.create.l HWIO_TCU_APPS_SMMU_SSD_REG_281_APPS_ADDR A:0x61e04464
y.create.l HWIO_TCU_APPS_SMMU_SSD_REG_282_APPS_ADDR A:0x61e04468
y.create.l HWIO_TCU_APPS_SMMU_SSD_REG_283_APPS_ADDR A:0x61e0446c
y.create.l HWIO_TCU_APPS_SMMU_SSD_REG_284_APPS_ADDR A:0x61e04470
y.create.l HWIO_TCU_APPS_SMMU_SSD_REG_285_APPS_ADDR A:0x61e04474
y.create.l HWIO_TCU_APPS_SMMU_SSD_REG_286_APPS_ADDR A:0x61e04478
y.create.l HWIO_TCU_APPS_SMMU_SSD_REG_287_APPS_ADDR A:0x61e0447c
y.create.l HWIO_TCU_APPS_SMMU_SSD_REG_288_APPS_ADDR A:0x61e04480
y.create.l HWIO_TCU_APPS_SMMU_SSD_REG_289_APPS_ADDR A:0x61e04484
y.create.l HWIO_TCU_APPS_SMMU_SSD_REG_290_APPS_ADDR A:0x61e04488
y.create.l HWIO_TCU_APPS_SMMU_SSD_REG_291_APPS_ADDR A:0x61e0448c
y.create.l HWIO_TCU_APPS_SMMU_SSD_REG_292_APPS_ADDR A:0x61e04490
y.create.l HWIO_TCU_APPS_SMMU_SSD_REG_293_APPS_ADDR A:0x61e04494
y.create.l HWIO_TCU_APPS_SMMU_SSD_REG_294_APPS_ADDR A:0x61e04498
y.create.l HWIO_TCU_APPS_SMMU_SSD_REG_295_APPS_ADDR A:0x61e0449c
y.create.l HWIO_TCU_APPS_SMMU_SSD_REG_296_APPS_ADDR A:0x61e044a0
y.create.l HWIO_TCU_APPS_SMMU_SSD_REG_297_APPS_ADDR A:0x61e044a4
y.create.l HWIO_TCU_APPS_SMMU_SSD_REG_298_APPS_ADDR A:0x61e044a8
y.create.l HWIO_TCU_APPS_SMMU_SSD_REG_299_APPS_ADDR A:0x61e044ac
y.create.l HWIO_TCU_APPS_SMMU_SSD_REG_300_APPS_ADDR A:0x61e044b0
y.create.l HWIO_TCU_APPS_SMMU_SSD_REG_301_APPS_ADDR A:0x61e044b4
y.create.l HWIO_TCU_APPS_SMMU_SSD_REG_302_APPS_ADDR A:0x61e044b8
y.create.l HWIO_TCU_APPS_SMMU_SSD_REG_303_APPS_ADDR A:0x61e044bc
y.create.l HWIO_TCU_APPS_SMMU_SSD_REG_304_APPS_ADDR A:0x61e044c0
y.create.l HWIO_TCU_APPS_SMMU_SSD_REG_305_APPS_ADDR A:0x61e044c4
y.create.l HWIO_TCU_APPS_SMMU_SSD_REG_306_APPS_ADDR A:0x61e044c8
y.create.l HWIO_TCU_APPS_SMMU_SSD_REG_307_APPS_ADDR A:0x61e044cc
y.create.l HWIO_TCU_APPS_SMMU_SSD_REG_308_APPS_ADDR A:0x61e044d0
y.create.l HWIO_TCU_APPS_SMMU_SSD_REG_309_APPS_ADDR A:0x61e044d4
y.create.l HWIO_TCU_APPS_SMMU_SSD_REG_310_APPS_ADDR A:0x61e044d8
y.create.l HWIO_TCU_APPS_SMMU_SSD_REG_311_APPS_ADDR A:0x61e044dc
y.create.l HWIO_TCU_APPS_SMMU_SSD_REG_312_APPS_ADDR A:0x61e044e0
y.create.l HWIO_TCU_APPS_SMMU_SSD_REG_313_APPS_ADDR A:0x61e044e4
y.create.l HWIO_TCU_APPS_SMMU_SSD_REG_314_APPS_ADDR A:0x61e044e8
y.create.l HWIO_TCU_APPS_SMMU_SSD_REG_315_APPS_ADDR A:0x61e044ec
y.create.l HWIO_TCU_APPS_SMMU_SSD_REG_316_APPS_ADDR A:0x61e044f0
y.create.l HWIO_TCU_APPS_SMMU_SSD_REG_317_APPS_ADDR A:0x61e044f4
y.create.l HWIO_TCU_APPS_SMMU_SSD_REG_318_APPS_ADDR A:0x61e044f8
y.create.l HWIO_TCU_APPS_SMMU_SSD_REG_319_APPS_ADDR A:0x61e044fc
y.create.l HWIO_TCU_APPS_SMMU_SSD_REG_320_APPS_ADDR A:0x61e04500
y.create.l HWIO_TCU_APPS_SMMU_SSD_REG_321_APPS_ADDR A:0x61e04504
y.create.l HWIO_TCU_APPS_SMMU_SSD_REG_322_APPS_ADDR A:0x61e04508
y.create.l HWIO_TCU_APPS_SMMU_SSD_REG_323_APPS_ADDR A:0x61e0450c
y.create.l HWIO_TCU_APPS_SMMU_SSD_REG_324_APPS_ADDR A:0x61e04510
y.create.l HWIO_TCU_APPS_SMMU_SSD_REG_325_APPS_ADDR A:0x61e04514
y.create.l HWIO_TCU_APPS_SMMU_SSD_REG_326_APPS_ADDR A:0x61e04518
y.create.l HWIO_TCU_APPS_SMMU_SSD_REG_327_APPS_ADDR A:0x61e0451c
y.create.l HWIO_TCU_APPS_SMMU_SSD_REG_328_APPS_ADDR A:0x61e04520
y.create.l HWIO_TCU_APPS_SMMU_SSD_REG_329_APPS_ADDR A:0x61e04524
y.create.l HWIO_TCU_APPS_SMMU_SSD_REG_330_APPS_ADDR A:0x61e04528
y.create.l HWIO_TCU_APPS_SMMU_SSD_REG_331_APPS_ADDR A:0x61e0452c
y.create.l HWIO_TCU_APPS_SMMU_SSD_REG_332_APPS_ADDR A:0x61e04530
y.create.l HWIO_TCU_APPS_SMMU_SSD_REG_333_APPS_ADDR A:0x61e04534
y.create.l HWIO_TCU_APPS_SMMU_SSD_REG_334_APPS_ADDR A:0x61e04538
y.create.l HWIO_TCU_APPS_SMMU_SSD_REG_335_APPS_ADDR A:0x61e0453c
y.create.l HWIO_TCU_APPS_SMMU_SSD_REG_336_APPS_ADDR A:0x61e04540
y.create.l HWIO_TCU_APPS_SMMU_SSD_REG_337_APPS_ADDR A:0x61e04544
y.create.l HWIO_TCU_APPS_SMMU_SSD_REG_338_APPS_ADDR A:0x61e04548
y.create.l HWIO_TCU_APPS_SMMU_SSD_REG_339_APPS_ADDR A:0x61e0454c
y.create.l HWIO_TCU_APPS_SMMU_SSD_REG_340_APPS_ADDR A:0x61e04550
y.create.l HWIO_TCU_APPS_SMMU_SSD_REG_341_APPS_ADDR A:0x61e04554
y.create.l HWIO_TCU_APPS_SMMU_SSD_REG_342_APPS_ADDR A:0x61e04558
y.create.l HWIO_TCU_APPS_SMMU_SSD_REG_343_APPS_ADDR A:0x61e0455c
y.create.l HWIO_TCU_APPS_SMMU_SSD_REG_344_APPS_ADDR A:0x61e04560
y.create.l HWIO_TCU_APPS_SMMU_SSD_REG_345_APPS_ADDR A:0x61e04564
y.create.l HWIO_TCU_APPS_SMMU_SSD_REG_346_APPS_ADDR A:0x61e04568
y.create.l HWIO_TCU_APPS_SMMU_SSD_REG_347_APPS_ADDR A:0x61e0456c
y.create.l HWIO_TCU_APPS_SMMU_SSD_REG_348_APPS_ADDR A:0x61e04570
y.create.l HWIO_TCU_APPS_SMMU_SSD_REG_349_APPS_ADDR A:0x61e04574
y.create.l HWIO_TCU_APPS_SMMU_SSD_REG_350_APPS_ADDR A:0x61e04578
y.create.l HWIO_TCU_APPS_SMMU_SSD_REG_351_APPS_ADDR A:0x61e0457c
y.create.l HWIO_TCU_APPS_SMMU_SSD_REG_352_APPS_ADDR A:0x61e04580
y.create.l HWIO_TCU_APPS_SMMU_SSD_REG_353_APPS_ADDR A:0x61e04584
y.create.l HWIO_TCU_APPS_SMMU_SSD_REG_354_APPS_ADDR A:0x61e04588
y.create.l HWIO_TCU_APPS_SMMU_SSD_REG_355_APPS_ADDR A:0x61e0458c
y.create.l HWIO_TCU_APPS_SMMU_SSD_REG_356_APPS_ADDR A:0x61e04590
y.create.l HWIO_TCU_APPS_SMMU_SSD_REG_357_APPS_ADDR A:0x61e04594
y.create.l HWIO_TCU_APPS_SMMU_SSD_REG_358_APPS_ADDR A:0x61e04598
y.create.l HWIO_TCU_APPS_SMMU_SSD_REG_359_APPS_ADDR A:0x61e0459c
y.create.l HWIO_TCU_APPS_SMMU_SSD_REG_360_APPS_ADDR A:0x61e045a0
y.create.l HWIO_TCU_APPS_SMMU_SSD_REG_361_APPS_ADDR A:0x61e045a4
y.create.l HWIO_TCU_APPS_SMMU_SSD_REG_362_APPS_ADDR A:0x61e045a8
y.create.l HWIO_TCU_APPS_SMMU_SSD_REG_363_APPS_ADDR A:0x61e045ac
y.create.l HWIO_TCU_APPS_SMMU_SSD_REG_364_APPS_ADDR A:0x61e045b0
y.create.l HWIO_TCU_APPS_SMMU_SSD_REG_365_APPS_ADDR A:0x61e045b4
y.create.l HWIO_TCU_APPS_SMMU_SSD_REG_366_APPS_ADDR A:0x61e045b8
y.create.l HWIO_TCU_APPS_SMMU_SSD_REG_367_APPS_ADDR A:0x61e045bc
y.create.l HWIO_TCU_APPS_SMMU_SSD_REG_368_APPS_ADDR A:0x61e045c0
y.create.l HWIO_TCU_APPS_SMMU_SSD_REG_369_APPS_ADDR A:0x61e045c4
y.create.l HWIO_TCU_APPS_SMMU_SSD_REG_370_APPS_ADDR A:0x61e045c8
y.create.l HWIO_TCU_APPS_SMMU_SSD_REG_371_APPS_ADDR A:0x61e045cc
y.create.l HWIO_TCU_APPS_SMMU_SSD_REG_372_APPS_ADDR A:0x61e045d0
y.create.l HWIO_TCU_APPS_SMMU_SSD_REG_373_APPS_ADDR A:0x61e045d4
y.create.l HWIO_TCU_APPS_SMMU_SSD_REG_374_APPS_ADDR A:0x61e045d8
y.create.l HWIO_TCU_APPS_SMMU_SSD_REG_375_APPS_ADDR A:0x61e045dc
y.create.l HWIO_TCU_APPS_SMMU_SSD_REG_376_APPS_ADDR A:0x61e045e0
y.create.l HWIO_TCU_APPS_SMMU_SSD_REG_377_APPS_ADDR A:0x61e045e4
y.create.l HWIO_TCU_APPS_SMMU_SSD_REG_378_APPS_ADDR A:0x61e045e8
y.create.l HWIO_TCU_APPS_SMMU_SSD_REG_379_APPS_ADDR A:0x61e045ec
y.create.l HWIO_TCU_APPS_SMMU_SSD_REG_380_APPS_ADDR A:0x61e045f0
y.create.l HWIO_TCU_APPS_SMMU_SSD_REG_381_APPS_ADDR A:0x61e045f4
y.create.l HWIO_TCU_APPS_SMMU_SSD_REG_382_APPS_ADDR A:0x61e045f8
y.create.l HWIO_TCU_APPS_SMMU_SSD_REG_383_APPS_ADDR A:0x61e045fc
y.create.l HWIO_TCU_APPS_SMMU_SSD_REG_384_APPS_ADDR A:0x61e04600
y.create.l HWIO_TCU_APPS_SMMU_SSD_REG_385_APPS_ADDR A:0x61e04604
y.create.l HWIO_TCU_APPS_SMMU_SSD_REG_386_APPS_ADDR A:0x61e04608
y.create.l HWIO_TCU_APPS_SMMU_SSD_REG_387_APPS_ADDR A:0x61e0460c
y.create.l HWIO_TCU_APPS_SMMU_SSD_REG_388_APPS_ADDR A:0x61e04610
y.create.l HWIO_TCU_APPS_SMMU_SSD_REG_389_APPS_ADDR A:0x61e04614
y.create.l HWIO_TCU_APPS_SMMU_SSD_REG_390_APPS_ADDR A:0x61e04618
y.create.l HWIO_TCU_APPS_SMMU_SSD_REG_391_APPS_ADDR A:0x61e0461c
y.create.l HWIO_TCU_APPS_SMMU_SSD_REG_392_APPS_ADDR A:0x61e04620
y.create.l HWIO_TCU_APPS_SMMU_SSD_REG_393_APPS_ADDR A:0x61e04624
y.create.l HWIO_TCU_APPS_SMMU_SSD_REG_394_APPS_ADDR A:0x61e04628
y.create.l HWIO_TCU_APPS_SMMU_SSD_REG_395_APPS_ADDR A:0x61e0462c
y.create.l HWIO_TCU_APPS_SMMU_SSD_REG_396_APPS_ADDR A:0x61e04630
y.create.l HWIO_TCU_APPS_SMMU_SSD_REG_397_APPS_ADDR A:0x61e04634
y.create.l HWIO_TCU_APPS_SMMU_SSD_REG_398_APPS_ADDR A:0x61e04638
y.create.l HWIO_TCU_APPS_SMMU_SSD_REG_399_APPS_ADDR A:0x61e0463c
y.create.l HWIO_TCU_APPS_SMMU_SSD_REG_400_APPS_ADDR A:0x61e04640
y.create.l HWIO_TCU_APPS_SMMU_SSD_REG_401_APPS_ADDR A:0x61e04644
y.create.l HWIO_TCU_APPS_SMMU_SSD_REG_402_APPS_ADDR A:0x61e04648
y.create.l HWIO_TCU_APPS_SMMU_SSD_REG_403_APPS_ADDR A:0x61e0464c
y.create.l HWIO_TCU_APPS_SMMU_SSD_REG_404_APPS_ADDR A:0x61e04650
y.create.l HWIO_TCU_APPS_SMMU_SSD_REG_405_APPS_ADDR A:0x61e04654
y.create.l HWIO_TCU_APPS_SMMU_SSD_REG_406_APPS_ADDR A:0x61e04658
y.create.l HWIO_TCU_APPS_SMMU_SSD_REG_407_APPS_ADDR A:0x61e0465c
y.create.l HWIO_TCU_APPS_SMMU_SSD_REG_408_APPS_ADDR A:0x61e04660
y.create.l HWIO_TCU_APPS_SMMU_SSD_REG_409_APPS_ADDR A:0x61e04664
y.create.l HWIO_TCU_APPS_SMMU_SSD_REG_410_APPS_ADDR A:0x61e04668
y.create.l HWIO_TCU_APPS_SMMU_SSD_REG_411_APPS_ADDR A:0x61e0466c
y.create.l HWIO_TCU_APPS_SMMU_SSD_REG_412_APPS_ADDR A:0x61e04670
y.create.l HWIO_TCU_APPS_SMMU_SSD_REG_413_APPS_ADDR A:0x61e04674
y.create.l HWIO_TCU_APPS_SMMU_SSD_REG_414_APPS_ADDR A:0x61e04678
y.create.l HWIO_TCU_APPS_SMMU_SSD_REG_415_APPS_ADDR A:0x61e0467c
y.create.l HWIO_TCU_APPS_SMMU_SSD_REG_416_APPS_ADDR A:0x61e04680
y.create.l HWIO_TCU_APPS_SMMU_SSD_REG_417_APPS_ADDR A:0x61e04684
y.create.l HWIO_TCU_APPS_SMMU_SSD_REG_418_APPS_ADDR A:0x61e04688
y.create.l HWIO_TCU_APPS_SMMU_SSD_REG_419_APPS_ADDR A:0x61e0468c
y.create.l HWIO_TCU_APPS_SMMU_SSD_REG_420_APPS_ADDR A:0x61e04690
y.create.l HWIO_TCU_APPS_SMMU_SSD_REG_421_APPS_ADDR A:0x61e04694
y.create.l HWIO_TCU_APPS_SMMU_SSD_REG_422_APPS_ADDR A:0x61e04698
y.create.l HWIO_TCU_APPS_SMMU_SSD_REG_423_APPS_ADDR A:0x61e0469c
y.create.l HWIO_TCU_APPS_SMMU_SSD_REG_424_APPS_ADDR A:0x61e046a0
y.create.l HWIO_TCU_APPS_SMMU_SSD_REG_425_APPS_ADDR A:0x61e046a4
y.create.l HWIO_TCU_APPS_SMMU_SSD_REG_426_APPS_ADDR A:0x61e046a8
y.create.l HWIO_TCU_APPS_SMMU_SSD_REG_427_APPS_ADDR A:0x61e046ac
y.create.l HWIO_TCU_APPS_SMMU_SSD_REG_428_APPS_ADDR A:0x61e046b0
y.create.l HWIO_TCU_APPS_SMMU_SSD_REG_429_APPS_ADDR A:0x61e046b4
y.create.l HWIO_TCU_APPS_SMMU_SSD_REG_430_APPS_ADDR A:0x61e046b8
y.create.l HWIO_TCU_APPS_SMMU_SSD_REG_431_APPS_ADDR A:0x61e046bc
y.create.l HWIO_TCU_APPS_SMMU_SSD_REG_432_APPS_ADDR A:0x61e046c0
y.create.l HWIO_TCU_APPS_SMMU_SSD_REG_433_APPS_ADDR A:0x61e046c4
y.create.l HWIO_TCU_APPS_SMMU_SSD_REG_434_APPS_ADDR A:0x61e046c8
y.create.l HWIO_TCU_APPS_SMMU_SSD_REG_435_APPS_ADDR A:0x61e046cc
y.create.l HWIO_TCU_APPS_SMMU_SSD_REG_436_APPS_ADDR A:0x61e046d0
y.create.l HWIO_TCU_APPS_SMMU_SSD_REG_437_APPS_ADDR A:0x61e046d4
y.create.l HWIO_TCU_APPS_SMMU_SSD_REG_438_APPS_ADDR A:0x61e046d8
y.create.l HWIO_TCU_APPS_SMMU_SSD_REG_439_APPS_ADDR A:0x61e046dc
y.create.l HWIO_TCU_APPS_SMMU_SSD_REG_440_APPS_ADDR A:0x61e046e0
y.create.l HWIO_TCU_APPS_SMMU_SSD_REG_441_APPS_ADDR A:0x61e046e4
y.create.l HWIO_TCU_APPS_SMMU_SSD_REG_442_APPS_ADDR A:0x61e046e8
y.create.l HWIO_TCU_APPS_SMMU_SSD_REG_443_APPS_ADDR A:0x61e046ec
y.create.l HWIO_TCU_APPS_SMMU_SSD_REG_444_APPS_ADDR A:0x61e046f0
y.create.l HWIO_TCU_APPS_SMMU_SSD_REG_445_APPS_ADDR A:0x61e046f4
y.create.l HWIO_TCU_APPS_SMMU_SSD_REG_446_APPS_ADDR A:0x61e046f8
y.create.l HWIO_TCU_APPS_SMMU_SSD_REG_447_APPS_ADDR A:0x61e046fc
y.create.l HWIO_TCU_APPS_SMMU_SSD_REG_448_APPS_ADDR A:0x61e04700
y.create.l HWIO_TCU_APPS_SMMU_SSD_REG_449_APPS_ADDR A:0x61e04704
y.create.l HWIO_TCU_APPS_SMMU_SSD_REG_450_APPS_ADDR A:0x61e04708
y.create.l HWIO_TCU_APPS_SMMU_SSD_REG_451_APPS_ADDR A:0x61e0470c
y.create.l HWIO_TCU_APPS_SMMU_SSD_REG_452_APPS_ADDR A:0x61e04710
y.create.l HWIO_TCU_APPS_SMMU_SSD_REG_453_APPS_ADDR A:0x61e04714
y.create.l HWIO_TCU_APPS_SMMU_SSD_REG_454_APPS_ADDR A:0x61e04718
y.create.l HWIO_TCU_APPS_SMMU_SSD_REG_455_APPS_ADDR A:0x61e0471c
y.create.l HWIO_TCU_APPS_SMMU_SSD_REG_456_APPS_ADDR A:0x61e04720
y.create.l HWIO_TCU_APPS_SMMU_SSD_REG_457_APPS_ADDR A:0x61e04724
y.create.l HWIO_TCU_APPS_SMMU_SSD_REG_458_APPS_ADDR A:0x61e04728
y.create.l HWIO_TCU_APPS_SMMU_SSD_REG_459_APPS_ADDR A:0x61e0472c
y.create.l HWIO_TCU_APPS_SMMU_SSD_REG_460_APPS_ADDR A:0x61e04730
y.create.l HWIO_TCU_APPS_SMMU_SSD_REG_461_APPS_ADDR A:0x61e04734
y.create.l HWIO_TCU_APPS_SMMU_SSD_REG_462_APPS_ADDR A:0x61e04738
y.create.l HWIO_TCU_APPS_SMMU_SSD_REG_463_APPS_ADDR A:0x61e0473c
y.create.l HWIO_TCU_APPS_SMMU_SSD_REG_464_APPS_ADDR A:0x61e04740
y.create.l HWIO_TCU_APPS_SMMU_SSD_REG_465_APPS_ADDR A:0x61e04744
y.create.l HWIO_TCU_APPS_SMMU_SSD_REG_466_APPS_ADDR A:0x61e04748
y.create.l HWIO_TCU_APPS_SMMU_SSD_REG_467_APPS_ADDR A:0x61e0474c
y.create.l HWIO_TCU_APPS_SMMU_SSD_REG_468_APPS_ADDR A:0x61e04750
y.create.l HWIO_TCU_APPS_SMMU_SSD_REG_469_APPS_ADDR A:0x61e04754
y.create.l HWIO_TCU_APPS_SMMU_SSD_REG_470_APPS_ADDR A:0x61e04758
y.create.l HWIO_TCU_APPS_SMMU_SSD_REG_471_APPS_ADDR A:0x61e0475c
y.create.l HWIO_TCU_APPS_SMMU_SSD_REG_472_APPS_ADDR A:0x61e04760
y.create.l HWIO_TCU_APPS_SMMU_SSD_REG_473_APPS_ADDR A:0x61e04764
y.create.l HWIO_TCU_APPS_SMMU_SSD_REG_474_APPS_ADDR A:0x61e04768
y.create.l HWIO_TCU_APPS_SMMU_SSD_REG_475_APPS_ADDR A:0x61e0476c
y.create.l HWIO_TCU_APPS_SMMU_SSD_REG_476_APPS_ADDR A:0x61e04770
y.create.l HWIO_TCU_APPS_SMMU_SSD_REG_477_APPS_ADDR A:0x61e04774
y.create.l HWIO_TCU_APPS_SMMU_SSD_REG_478_APPS_ADDR A:0x61e04778
y.create.l HWIO_TCU_APPS_SMMU_SSD_REG_479_APPS_ADDR A:0x61e0477c
y.create.l HWIO_TCU_APPS_SMMU_SSD_REG_480_APPS_ADDR A:0x61e04780
y.create.l HWIO_TCU_APPS_SMMU_SSD_REG_481_APPS_ADDR A:0x61e04784
y.create.l HWIO_TCU_APPS_SMMU_SSD_REG_482_APPS_ADDR A:0x61e04788
y.create.l HWIO_TCU_APPS_SMMU_SSD_REG_483_APPS_ADDR A:0x61e0478c
y.create.l HWIO_TCU_APPS_SMMU_SSD_REG_484_APPS_ADDR A:0x61e04790
y.create.l HWIO_TCU_APPS_SMMU_SSD_REG_485_APPS_ADDR A:0x61e04794
y.create.l HWIO_TCU_APPS_SMMU_SSD_REG_486_APPS_ADDR A:0x61e04798
y.create.l HWIO_TCU_APPS_SMMU_SSD_REG_487_APPS_ADDR A:0x61e0479c
y.create.l HWIO_TCU_APPS_SMMU_SSD_REG_488_APPS_ADDR A:0x61e047a0
y.create.l HWIO_TCU_APPS_SMMU_SSD_REG_489_APPS_ADDR A:0x61e047a4
y.create.l HWIO_TCU_APPS_SMMU_SSD_REG_490_APPS_ADDR A:0x61e047a8
y.create.l HWIO_TCU_APPS_SMMU_SSD_REG_491_APPS_ADDR A:0x61e047ac
y.create.l HWIO_TCU_APPS_SMMU_SSD_REG_492_APPS_ADDR A:0x61e047b0
y.create.l HWIO_TCU_APPS_SMMU_SSD_REG_493_APPS_ADDR A:0x61e047b4
y.create.l HWIO_TCU_APPS_SMMU_SSD_REG_494_APPS_ADDR A:0x61e047b8
y.create.l HWIO_TCU_APPS_SMMU_SSD_REG_495_APPS_ADDR A:0x61e047bc
y.create.l HWIO_TCU_APPS_SMMU_SSD_REG_496_APPS_ADDR A:0x61e047c0
y.create.l HWIO_TCU_APPS_SMMU_SSD_REG_497_APPS_ADDR A:0x61e047c4
y.create.l HWIO_TCU_APPS_SMMU_SSD_REG_498_APPS_ADDR A:0x61e047c8
y.create.l HWIO_TCU_APPS_SMMU_SSD_REG_499_APPS_ADDR A:0x61e047cc
y.create.l HWIO_TCU_APPS_SMMU_SSD_REG_500_APPS_ADDR A:0x61e047d0
y.create.l HWIO_TCU_APPS_SMMU_SSD_REG_501_APPS_ADDR A:0x61e047d4
y.create.l HWIO_TCU_APPS_SMMU_SSD_REG_502_APPS_ADDR A:0x61e047d8
y.create.l HWIO_TCU_APPS_SMMU_SSD_REG_503_APPS_ADDR A:0x61e047dc
y.create.l HWIO_TCU_APPS_SMMU_SSD_REG_504_APPS_ADDR A:0x61e047e0
y.create.l HWIO_TCU_APPS_SMMU_SSD_REG_505_APPS_ADDR A:0x61e047e4
y.create.l HWIO_TCU_APPS_SMMU_SSD_REG_506_APPS_ADDR A:0x61e047e8
y.create.l HWIO_TCU_APPS_SMMU_SSD_REG_507_APPS_ADDR A:0x61e047ec
y.create.l HWIO_TCU_APPS_SMMU_SSD_REG_508_APPS_ADDR A:0x61e047f0
y.create.l HWIO_TCU_APPS_SMMU_SSD_REG_509_APPS_ADDR A:0x61e047f4
y.create.l HWIO_TCU_APPS_SMMU_SSD_REG_510_APPS_ADDR A:0x61e047f8
y.create.l HWIO_TCU_APPS_SMMU_SSD_REG_511_APPS_ADDR A:0x61e047fc
y.create.l HWIO_TCU_APPS_SMMU_SSD_REG_512_APPS_ADDR A:0x61e04800
y.create.l HWIO_TCU_APPS_SMMU_SSD_REG_513_APPS_ADDR A:0x61e04804
y.create.l HWIO_TCU_APPS_SMMU_SSD_REG_514_APPS_ADDR A:0x61e04808
y.create.l HWIO_TCU_APPS_SMMU_SSD_REG_515_APPS_ADDR A:0x61e0480c
y.create.l HWIO_TCU_APPS_SMMU_SSD_REG_516_APPS_ADDR A:0x61e04810
y.create.l HWIO_TCU_APPS_SMMU_SSD_REG_517_APPS_ADDR A:0x61e04814
y.create.l HWIO_TCU_APPS_SMMU_SSD_REG_518_APPS_ADDR A:0x61e04818
y.create.l HWIO_TCU_APPS_SMMU_SSD_REG_519_APPS_ADDR A:0x61e0481c
y.create.l HWIO_TCU_APPS_SMMU_SSD_REG_520_APPS_ADDR A:0x61e04820
y.create.l HWIO_TCU_APPS_SMMU_SSD_REG_521_APPS_ADDR A:0x61e04824
y.create.l HWIO_TCU_APPS_SMMU_SSD_REG_522_APPS_ADDR A:0x61e04828
y.create.l HWIO_TCU_APPS_SMMU_SSD_REG_523_APPS_ADDR A:0x61e0482c
y.create.l HWIO_TCU_APPS_SMMU_SSD_REG_524_APPS_ADDR A:0x61e04830
y.create.l HWIO_TCU_APPS_SMMU_SSD_REG_525_APPS_ADDR A:0x61e04834
y.create.l HWIO_TCU_APPS_SMMU_SSD_REG_526_APPS_ADDR A:0x61e04838
y.create.l HWIO_TCU_APPS_SMMU_SSD_REG_527_APPS_ADDR A:0x61e0483c
y.create.l HWIO_TCU_APPS_SMMU_SSD_REG_528_APPS_ADDR A:0x61e04840
y.create.l HWIO_TCU_APPS_SMMU_SSD_REG_529_APPS_ADDR A:0x61e04844
y.create.l HWIO_TCU_APPS_SMMU_SSD_REG_530_APPS_ADDR A:0x61e04848
y.create.l HWIO_TCU_APPS_SMMU_SSD_REG_531_APPS_ADDR A:0x61e0484c
y.create.l HWIO_TCU_APPS_SMMU_SSD_REG_532_APPS_ADDR A:0x61e04850
y.create.l HWIO_TCU_APPS_SMMU_SSD_REG_533_APPS_ADDR A:0x61e04854
y.create.l HWIO_TCU_APPS_SMMU_SSD_REG_534_APPS_ADDR A:0x61e04858
y.create.l HWIO_TCU_APPS_SMMU_SSD_REG_535_APPS_ADDR A:0x61e0485c
y.create.l HWIO_TCU_APPS_SMMU_SSD_REG_536_APPS_ADDR A:0x61e04860
y.create.l HWIO_TCU_APPS_SMMU_SSD_REG_537_APPS_ADDR A:0x61e04864
y.create.l HWIO_TCU_APPS_SMMU_SSD_REG_538_APPS_ADDR A:0x61e04868
y.create.l HWIO_TCU_APPS_SMMU_SSD_REG_539_APPS_ADDR A:0x61e0486c
y.create.l HWIO_TCU_APPS_SMMU_SSD_REG_540_APPS_ADDR A:0x61e04870
y.create.l HWIO_TCU_APPS_SMMU_SSD_REG_541_APPS_ADDR A:0x61e04874
y.create.l HWIO_TCU_APPS_SMMU_SSD_REG_542_APPS_ADDR A:0x61e04878
y.create.l HWIO_TCU_APPS_SMMU_SSD_REG_543_APPS_ADDR A:0x61e0487c
y.create.l HWIO_TCU_APPS_SMMU_SSD_REG_544_APPS_ADDR A:0x61e04880
y.create.l HWIO_TCU_APPS_SMMU_SSD_REG_545_APPS_ADDR A:0x61e04884
y.create.l HWIO_TCU_APPS_SMMU_SSD_REG_546_APPS_ADDR A:0x61e04888
y.create.l HWIO_TCU_APPS_SMMU_SSD_REG_547_APPS_ADDR A:0x61e0488c
y.create.l HWIO_TCU_APPS_SMMU_SSD_REG_548_APPS_ADDR A:0x61e04890
y.create.l HWIO_TCU_APPS_SMMU_SSD_REG_549_APPS_ADDR A:0x61e04894
y.create.l HWIO_TCU_APPS_SMMU_SSD_REG_550_APPS_ADDR A:0x61e04898
y.create.l HWIO_TCU_APPS_SMMU_SSD_REG_551_APPS_ADDR A:0x61e0489c
y.create.l HWIO_TCU_APPS_SMMU_SSD_REG_552_APPS_ADDR A:0x61e048a0
y.create.l HWIO_TCU_APPS_SMMU_SSD_REG_553_APPS_ADDR A:0x61e048a4
y.create.l HWIO_TCU_APPS_SMMU_SSD_REG_554_APPS_ADDR A:0x61e048a8
y.create.l HWIO_TCU_APPS_SMMU_SSD_REG_555_APPS_ADDR A:0x61e048ac
y.create.l HWIO_TCU_APPS_SMMU_SSD_REG_556_APPS_ADDR A:0x61e048b0
y.create.l HWIO_TCU_APPS_SMMU_SSD_REG_557_APPS_ADDR A:0x61e048b4
y.create.l HWIO_TCU_APPS_SMMU_SSD_REG_558_APPS_ADDR A:0x61e048b8
y.create.l HWIO_TCU_APPS_SMMU_SSD_REG_559_APPS_ADDR A:0x61e048bc
y.create.l HWIO_TCU_APPS_SMMU_SSD_REG_560_APPS_ADDR A:0x61e048c0
y.create.l HWIO_TCU_APPS_SMMU_SSD_REG_561_APPS_ADDR A:0x61e048c4
y.create.l HWIO_TCU_APPS_SMMU_SSD_REG_562_APPS_ADDR A:0x61e048c8
y.create.l HWIO_TCU_APPS_SMMU_SSD_REG_563_APPS_ADDR A:0x61e048cc
y.create.l HWIO_TCU_APPS_SMMU_SSD_REG_564_APPS_ADDR A:0x61e048d0
y.create.l HWIO_TCU_APPS_SMMU_SSD_REG_565_APPS_ADDR A:0x61e048d4
y.create.l HWIO_TCU_APPS_SMMU_SSD_REG_566_APPS_ADDR A:0x61e048d8
y.create.l HWIO_TCU_APPS_SMMU_SSD_REG_567_APPS_ADDR A:0x61e048dc
y.create.l HWIO_TCU_APPS_SMMU_SSD_REG_568_APPS_ADDR A:0x61e048e0
y.create.l HWIO_TCU_APPS_SMMU_SSD_REG_569_APPS_ADDR A:0x61e048e4
y.create.l HWIO_TCU_APPS_SMMU_SSD_REG_570_APPS_ADDR A:0x61e048e8
y.create.l HWIO_TCU_APPS_SMMU_SSD_REG_571_APPS_ADDR A:0x61e048ec
y.create.l HWIO_TCU_APPS_SMMU_SSD_REG_572_APPS_ADDR A:0x61e048f0
y.create.l HWIO_TCU_APPS_SMMU_SSD_REG_573_APPS_ADDR A:0x61e048f4
y.create.l HWIO_TCU_APPS_SMMU_SSD_REG_574_APPS_ADDR A:0x61e048f8
y.create.l HWIO_TCU_APPS_SMMU_SSD_REG_575_APPS_ADDR A:0x61e048fc
y.create.l HWIO_TCU_APPS_SMMU_SSD_REG_576_APPS_ADDR A:0x61e04900
y.create.l HWIO_TCU_APPS_SMMU_SSD_REG_577_APPS_ADDR A:0x61e04904
y.create.l HWIO_TCU_APPS_SMMU_SSD_REG_578_APPS_ADDR A:0x61e04908
y.create.l HWIO_TCU_APPS_SMMU_SSD_REG_579_APPS_ADDR A:0x61e0490c
y.create.l HWIO_TCU_APPS_SMMU_SSD_REG_580_APPS_ADDR A:0x61e04910
y.create.l HWIO_TCU_APPS_SMMU_SSD_REG_581_APPS_ADDR A:0x61e04914
y.create.l HWIO_TCU_APPS_SMMU_SSD_REG_582_APPS_ADDR A:0x61e04918
y.create.l HWIO_TCU_APPS_SMMU_SSD_REG_583_APPS_ADDR A:0x61e0491c
y.create.l HWIO_TCU_APPS_SMMU_SSD_REG_584_APPS_ADDR A:0x61e04920
y.create.l HWIO_TCU_APPS_SMMU_SSD_REG_585_APPS_ADDR A:0x61e04924
y.create.l HWIO_TCU_APPS_SMMU_SSD_REG_586_APPS_ADDR A:0x61e04928
y.create.l HWIO_TCU_APPS_SMMU_SSD_REG_587_APPS_ADDR A:0x61e0492c
y.create.l HWIO_TCU_APPS_SMMU_SSD_REG_588_APPS_ADDR A:0x61e04930
y.create.l HWIO_TCU_APPS_SMMU_SSD_REG_589_APPS_ADDR A:0x61e04934
y.create.l HWIO_TCU_APPS_SMMU_SSD_REG_590_APPS_ADDR A:0x61e04938
y.create.l HWIO_TCU_APPS_SMMU_SSD_REG_591_APPS_ADDR A:0x61e0493c
y.create.l HWIO_TCU_APPS_SMMU_SSD_REG_592_APPS_ADDR A:0x61e04940
y.create.l HWIO_TCU_APPS_SMMU_SSD_REG_593_APPS_ADDR A:0x61e04944
y.create.l HWIO_TCU_APPS_SMMU_SSD_REG_594_APPS_ADDR A:0x61e04948
y.create.l HWIO_TCU_APPS_SMMU_SSD_REG_595_APPS_ADDR A:0x61e0494c
y.create.l HWIO_TCU_APPS_SMMU_SSD_REG_596_APPS_ADDR A:0x61e04950
y.create.l HWIO_TCU_APPS_SMMU_SSD_REG_597_APPS_ADDR A:0x61e04954
y.create.l HWIO_TCU_APPS_SMMU_SSD_REG_598_APPS_ADDR A:0x61e04958
y.create.l HWIO_TCU_APPS_SMMU_SSD_REG_599_APPS_ADDR A:0x61e0495c
y.create.l HWIO_TCU_APPS_SMMU_SSD_REG_600_APPS_ADDR A:0x61e04960
y.create.l HWIO_TCU_APPS_SMMU_SSD_REG_601_APPS_ADDR A:0x61e04964
y.create.l HWIO_TCU_APPS_SMMU_SSD_REG_602_APPS_ADDR A:0x61e04968
y.create.l HWIO_TCU_APPS_SMMU_SSD_REG_603_APPS_ADDR A:0x61e0496c
y.create.l HWIO_TCU_APPS_SMMU_SSD_REG_604_APPS_ADDR A:0x61e04970
y.create.l HWIO_TCU_APPS_SMMU_SSD_REG_605_APPS_ADDR A:0x61e04974
y.create.l HWIO_TCU_APPS_SMMU_SSD_REG_606_APPS_ADDR A:0x61e04978
y.create.l HWIO_TCU_APPS_SMMU_SSD_REG_607_APPS_ADDR A:0x61e0497c
y.create.l HWIO_TCU_APPS_SMMU_SSD_REG_608_APPS_ADDR A:0x61e04980
y.create.l HWIO_TCU_APPS_SMMU_SSD_REG_609_APPS_ADDR A:0x61e04984
y.create.l HWIO_TCU_APPS_SMMU_SSD_REG_610_APPS_ADDR A:0x61e04988
y.create.l HWIO_TCU_APPS_SMMU_SSD_REG_611_APPS_ADDR A:0x61e0498c
y.create.l HWIO_TCU_APPS_SMMU_SSD_REG_612_APPS_ADDR A:0x61e04990
y.create.l HWIO_TCU_APPS_SMMU_SSD_REG_613_APPS_ADDR A:0x61e04994
y.create.l HWIO_TCU_APPS_SMMU_SSD_REG_614_APPS_ADDR A:0x61e04998
y.create.l HWIO_TCU_APPS_SMMU_SSD_REG_615_APPS_ADDR A:0x61e0499c
y.create.l HWIO_TCU_APPS_SMMU_SSD_REG_616_APPS_ADDR A:0x61e049a0
y.create.l HWIO_TCU_APPS_SMMU_SSD_REG_617_APPS_ADDR A:0x61e049a4
y.create.l HWIO_TCU_APPS_SMMU_SSD_REG_618_APPS_ADDR A:0x61e049a8
y.create.l HWIO_TCU_APPS_SMMU_SSD_REG_619_APPS_ADDR A:0x61e049ac
y.create.l HWIO_TCU_APPS_SMMU_SSD_REG_620_APPS_ADDR A:0x61e049b0
y.create.l HWIO_TCU_APPS_SMMU_SSD_REG_621_APPS_ADDR A:0x61e049b4
y.create.l HWIO_TCU_APPS_SMMU_SSD_REG_622_APPS_ADDR A:0x61e049b8
y.create.l HWIO_TCU_APPS_SMMU_SSD_REG_623_APPS_ADDR A:0x61e049bc
y.create.l HWIO_TCU_APPS_SMMU_SSD_REG_624_APPS_ADDR A:0x61e049c0
y.create.l HWIO_TCU_APPS_SMMU_SSD_REG_625_APPS_ADDR A:0x61e049c4
y.create.l HWIO_TCU_APPS_SMMU_SSD_REG_626_APPS_ADDR A:0x61e049c8
y.create.l HWIO_TCU_APPS_SMMU_SSD_REG_627_APPS_ADDR A:0x61e049cc
y.create.l HWIO_TCU_APPS_SMMU_SSD_REG_628_APPS_ADDR A:0x61e049d0
y.create.l HWIO_TCU_APPS_SMMU_SSD_REG_629_APPS_ADDR A:0x61e049d4
y.create.l HWIO_TCU_APPS_SMMU_SSD_REG_630_APPS_ADDR A:0x61e049d8
y.create.l HWIO_TCU_APPS_SMMU_SSD_REG_631_APPS_ADDR A:0x61e049dc
y.create.l HWIO_TCU_APPS_SMMU_SSD_REG_632_APPS_ADDR A:0x61e049e0
y.create.l HWIO_TCU_APPS_SMMU_SSD_REG_633_APPS_ADDR A:0x61e049e4
y.create.l HWIO_TCU_APPS_SMMU_SSD_REG_634_APPS_ADDR A:0x61e049e8
y.create.l HWIO_TCU_APPS_SMMU_SSD_REG_635_APPS_ADDR A:0x61e049ec
y.create.l HWIO_TCU_APPS_SMMU_SSD_REG_636_APPS_ADDR A:0x61e049f0
y.create.l HWIO_TCU_APPS_SMMU_SSD_REG_637_APPS_ADDR A:0x61e049f4
y.create.l HWIO_TCU_APPS_SMMU_SSD_REG_638_APPS_ADDR A:0x61e049f8
y.create.l HWIO_TCU_APPS_SMMU_SSD_REG_639_APPS_ADDR A:0x61e049fc
y.create.l HWIO_TCU_APPS_SMMU_SSD_REG_640_APPS_ADDR A:0x61e04a00
y.create.l HWIO_TCU_APPS_SMMU_SSD_REG_641_APPS_ADDR A:0x61e04a04
y.create.l HWIO_TCU_APPS_SMMU_SSD_REG_642_APPS_ADDR A:0x61e04a08
y.create.l HWIO_TCU_APPS_SMMU_SSD_REG_643_APPS_ADDR A:0x61e04a0c
y.create.l HWIO_TCU_APPS_SMMU_SSD_REG_644_APPS_ADDR A:0x61e04a10
y.create.l HWIO_TCU_APPS_SMMU_SSD_REG_645_APPS_ADDR A:0x61e04a14
y.create.l HWIO_TCU_APPS_SMMU_SSD_REG_646_APPS_ADDR A:0x61e04a18
y.create.l HWIO_TCU_APPS_SMMU_SSD_REG_647_APPS_ADDR A:0x61e04a1c
y.create.l HWIO_TCU_APPS_SMMU_SSD_REG_648_APPS_ADDR A:0x61e04a20
y.create.l HWIO_TCU_APPS_SMMU_SSD_REG_649_APPS_ADDR A:0x61e04a24
y.create.l HWIO_TCU_APPS_SMMU_SSD_REG_650_APPS_ADDR A:0x61e04a28
y.create.l HWIO_TCU_APPS_SMMU_SSD_REG_651_APPS_ADDR A:0x61e04a2c
y.create.l HWIO_TCU_APPS_SMMU_SSD_REG_652_APPS_ADDR A:0x61e04a30
y.create.l HWIO_TCU_APPS_SMMU_SSD_REG_653_APPS_ADDR A:0x61e04a34
y.create.l HWIO_TCU_APPS_SMMU_SSD_REG_654_APPS_ADDR A:0x61e04a38
y.create.l HWIO_TCU_APPS_SMMU_SSD_REG_655_APPS_ADDR A:0x61e04a3c
y.create.l HWIO_TCU_APPS_SMMU_SSD_REG_656_APPS_ADDR A:0x61e04a40
y.create.l HWIO_TCU_APPS_SMMU_SSD_REG_657_APPS_ADDR A:0x61e04a44
y.create.l HWIO_TCU_APPS_SMMU_SSD_REG_658_APPS_ADDR A:0x61e04a48
y.create.l HWIO_TCU_APPS_SMMU_SSD_REG_659_APPS_ADDR A:0x61e04a4c
y.create.l HWIO_TCU_APPS_SMMU_SSD_REG_660_APPS_ADDR A:0x61e04a50
y.create.l HWIO_TCU_APPS_SMMU_SSD_REG_661_APPS_ADDR A:0x61e04a54
y.create.l HWIO_TCU_APPS_SMMU_SSD_REG_662_APPS_ADDR A:0x61e04a58
y.create.l HWIO_TCU_APPS_SMMU_SSD_REG_663_APPS_ADDR A:0x61e04a5c
y.create.l HWIO_TCU_APPS_SMMU_SSD_REG_664_APPS_ADDR A:0x61e04a60
y.create.l HWIO_TCU_APPS_SMMU_SSD_REG_665_APPS_ADDR A:0x61e04a64
y.create.l HWIO_TCU_APPS_SMMU_SSD_REG_666_APPS_ADDR A:0x61e04a68
y.create.l HWIO_TCU_APPS_SMMU_SSD_REG_667_APPS_ADDR A:0x61e04a6c
y.create.l HWIO_TCU_APPS_SMMU_SSD_REG_668_APPS_ADDR A:0x61e04a70
y.create.l HWIO_TCU_APPS_SMMU_SSD_REG_669_APPS_ADDR A:0x61e04a74
y.create.l HWIO_TCU_APPS_SMMU_SSD_REG_670_APPS_ADDR A:0x61e04a78
y.create.l HWIO_TCU_APPS_SMMU_SSD_REG_671_APPS_ADDR A:0x61e04a7c
y.create.l HWIO_TCU_APPS_SMMU_SSD_REG_672_APPS_ADDR A:0x61e04a80
y.create.l HWIO_TCU_APPS_SMMU_SSD_REG_673_APPS_ADDR A:0x61e04a84
y.create.l HWIO_TCU_APPS_SMMU_SSD_REG_674_APPS_ADDR A:0x61e04a88
y.create.l HWIO_TCU_APPS_SMMU_SSD_REG_675_APPS_ADDR A:0x61e04a8c
y.create.l HWIO_TCU_APPS_SMMU_SSD_REG_676_APPS_ADDR A:0x61e04a90
y.create.l HWIO_TCU_APPS_SMMU_SSD_REG_677_APPS_ADDR A:0x61e04a94
y.create.l HWIO_TCU_APPS_SMMU_SSD_REG_678_APPS_ADDR A:0x61e04a98
y.create.l HWIO_TCU_APPS_SMMU_SSD_REG_679_APPS_ADDR A:0x61e04a9c
y.create.l HWIO_TCU_APPS_SMMU_SSD_REG_680_APPS_ADDR A:0x61e04aa0
y.create.l HWIO_TCU_APPS_SMMU_SSD_REG_681_APPS_ADDR A:0x61e04aa4
y.create.l HWIO_TCU_APPS_SMMU_SSD_REG_682_APPS_ADDR A:0x61e04aa8
y.create.l HWIO_TCU_APPS_SMMU_SSD_REG_683_APPS_ADDR A:0x61e04aac
y.create.l HWIO_TCU_APPS_SMMU_SSD_REG_684_APPS_ADDR A:0x61e04ab0
y.create.l HWIO_TCU_APPS_SMMU_SSD_REG_685_APPS_ADDR A:0x61e04ab4
y.create.l HWIO_TCU_APPS_SMMU_SSD_REG_686_APPS_ADDR A:0x61e04ab8
y.create.l HWIO_TCU_APPS_SMMU_SSD_REG_687_APPS_ADDR A:0x61e04abc
y.create.l HWIO_TCU_APPS_SMMU_SSD_REG_688_APPS_ADDR A:0x61e04ac0
y.create.l HWIO_TCU_APPS_SMMU_SSD_REG_689_APPS_ADDR A:0x61e04ac4
y.create.l HWIO_TCU_APPS_SMMU_SSD_REG_690_APPS_ADDR A:0x61e04ac8
y.create.l HWIO_TCU_APPS_SMMU_SSD_REG_691_APPS_ADDR A:0x61e04acc
y.create.l HWIO_TCU_APPS_SMMU_SSD_REG_692_APPS_ADDR A:0x61e04ad0
y.create.l HWIO_TCU_APPS_SMMU_SSD_REG_693_APPS_ADDR A:0x61e04ad4
y.create.l HWIO_TCU_APPS_SMMU_SSD_REG_694_APPS_ADDR A:0x61e04ad8
y.create.l HWIO_TCU_APPS_SMMU_SSD_REG_695_APPS_ADDR A:0x61e04adc
y.create.l HWIO_TCU_APPS_SMMU_SSD_REG_696_APPS_ADDR A:0x61e04ae0
y.create.l HWIO_TCU_APPS_SMMU_SSD_REG_697_APPS_ADDR A:0x61e04ae4
y.create.l HWIO_TCU_APPS_SMMU_SSD_REG_698_APPS_ADDR A:0x61e04ae8
y.create.l HWIO_TCU_APPS_SMMU_SSD_REG_699_APPS_ADDR A:0x61e04aec
y.create.l HWIO_TCU_APPS_SMMU_SSD_REG_700_APPS_ADDR A:0x61e04af0
y.create.l HWIO_TCU_APPS_SMMU_SSD_REG_701_APPS_ADDR A:0x61e04af4
y.create.l HWIO_TCU_APPS_SMMU_SSD_REG_702_APPS_ADDR A:0x61e04af8
y.create.l HWIO_TCU_APPS_SMMU_SSD_REG_703_APPS_ADDR A:0x61e04afc
y.create.l HWIO_TCU_APPS_SMMU_SSD_REG_704_APPS_ADDR A:0x61e04b00
y.create.l HWIO_TCU_APPS_SMMU_SSD_REG_705_APPS_ADDR A:0x61e04b04
y.create.l HWIO_TCU_APPS_SMMU_SSD_REG_706_APPS_ADDR A:0x61e04b08
y.create.l HWIO_TCU_APPS_SMMU_SSD_REG_707_APPS_ADDR A:0x61e04b0c
y.create.l HWIO_TCU_APPS_SMMU_SSD_REG_708_APPS_ADDR A:0x61e04b10
y.create.l HWIO_TCU_APPS_SMMU_SSD_REG_709_APPS_ADDR A:0x61e04b14
y.create.l HWIO_TCU_APPS_SMMU_SSD_REG_710_APPS_ADDR A:0x61e04b18
y.create.l HWIO_TCU_APPS_SMMU_SSD_REG_711_APPS_ADDR A:0x61e04b1c
y.create.l HWIO_TCU_APPS_SMMU_SSD_REG_712_APPS_ADDR A:0x61e04b20
y.create.l HWIO_TCU_APPS_SMMU_SSD_REG_713_APPS_ADDR A:0x61e04b24
y.create.l HWIO_TCU_APPS_SMMU_SSD_REG_714_APPS_ADDR A:0x61e04b28
y.create.l HWIO_TCU_APPS_SMMU_SSD_REG_715_APPS_ADDR A:0x61e04b2c
y.create.l HWIO_TCU_APPS_SMMU_SSD_REG_716_APPS_ADDR A:0x61e04b30
y.create.l HWIO_TCU_APPS_SMMU_SSD_REG_717_APPS_ADDR A:0x61e04b34
y.create.l HWIO_TCU_APPS_SMMU_SSD_REG_718_APPS_ADDR A:0x61e04b38
y.create.l HWIO_TCU_APPS_SMMU_SSD_REG_719_APPS_ADDR A:0x61e04b3c
y.create.l HWIO_TCU_APPS_SMMU_SSD_REG_720_APPS_ADDR A:0x61e04b40
y.create.l HWIO_TCU_APPS_SMMU_SSD_REG_721_APPS_ADDR A:0x61e04b44
y.create.l HWIO_TCU_APPS_SMMU_SSD_REG_722_APPS_ADDR A:0x61e04b48
y.create.l HWIO_TCU_APPS_SMMU_SSD_REG_723_APPS_ADDR A:0x61e04b4c
y.create.l HWIO_TCU_APPS_SMMU_SSD_REG_724_APPS_ADDR A:0x61e04b50
y.create.l HWIO_TCU_APPS_SMMU_SSD_REG_725_APPS_ADDR A:0x61e04b54
y.create.l HWIO_TCU_APPS_SMMU_SSD_REG_726_APPS_ADDR A:0x61e04b58
y.create.l HWIO_TCU_APPS_SMMU_SSD_REG_727_APPS_ADDR A:0x61e04b5c
y.create.l HWIO_TCU_APPS_SMMU_SSD_REG_728_APPS_ADDR A:0x61e04b60
y.create.l HWIO_TCU_APPS_SMMU_SSD_REG_729_APPS_ADDR A:0x61e04b64
y.create.l HWIO_TCU_APPS_SMMU_SSD_REG_730_APPS_ADDR A:0x61e04b68
y.create.l HWIO_TCU_APPS_SMMU_SSD_REG_731_APPS_ADDR A:0x61e04b6c
y.create.l HWIO_TCU_APPS_SMMU_SSD_REG_732_APPS_ADDR A:0x61e04b70
y.create.l HWIO_TCU_APPS_SMMU_SSD_REG_733_APPS_ADDR A:0x61e04b74
y.create.l HWIO_TCU_APPS_SMMU_SSD_REG_734_APPS_ADDR A:0x61e04b78
y.create.l HWIO_TCU_APPS_SMMU_SSD_REG_735_APPS_ADDR A:0x61e04b7c
y.create.l HWIO_TCU_APPS_SMMU_SSD_REG_736_APPS_ADDR A:0x61e04b80
y.create.l HWIO_TCU_APPS_SMMU_SSD_REG_737_APPS_ADDR A:0x61e04b84
y.create.l HWIO_TCU_APPS_SMMU_SSD_REG_738_APPS_ADDR A:0x61e04b88
y.create.l HWIO_TCU_APPS_SMMU_SSD_REG_739_APPS_ADDR A:0x61e04b8c
y.create.l HWIO_TCU_APPS_SMMU_SSD_REG_740_APPS_ADDR A:0x61e04b90
y.create.l HWIO_TCU_APPS_SMMU_SSD_REG_741_APPS_ADDR A:0x61e04b94
y.create.l HWIO_TCU_APPS_SMMU_SSD_REG_742_APPS_ADDR A:0x61e04b98
y.create.l HWIO_TCU_APPS_SMMU_SSD_REG_743_APPS_ADDR A:0x61e04b9c
y.create.l HWIO_TCU_APPS_SMMU_SSD_REG_744_APPS_ADDR A:0x61e04ba0
y.create.l HWIO_TCU_APPS_SMMU_SSD_REG_745_APPS_ADDR A:0x61e04ba4
y.create.l HWIO_TCU_APPS_SMMU_SSD_REG_746_APPS_ADDR A:0x61e04ba8
y.create.l HWIO_TCU_APPS_SMMU_SSD_REG_747_APPS_ADDR A:0x61e04bac
y.create.l HWIO_TCU_APPS_SMMU_SSD_REG_748_APPS_ADDR A:0x61e04bb0
y.create.l HWIO_TCU_APPS_SMMU_SSD_REG_749_APPS_ADDR A:0x61e04bb4
y.create.l HWIO_TCU_APPS_SMMU_SSD_REG_750_APPS_ADDR A:0x61e04bb8
y.create.l HWIO_TCU_APPS_SMMU_SSD_REG_751_APPS_ADDR A:0x61e04bbc
y.create.l HWIO_TCU_APPS_SMMU_SSD_REG_752_APPS_ADDR A:0x61e04bc0
y.create.l HWIO_TCU_APPS_SMMU_SSD_REG_753_APPS_ADDR A:0x61e04bc4
y.create.l HWIO_TCU_APPS_SMMU_SSD_REG_754_APPS_ADDR A:0x61e04bc8
y.create.l HWIO_TCU_APPS_SMMU_SSD_REG_755_APPS_ADDR A:0x61e04bcc
y.create.l HWIO_TCU_APPS_SMMU_SSD_REG_756_APPS_ADDR A:0x61e04bd0
y.create.l HWIO_TCU_APPS_SMMU_SSD_REG_757_APPS_ADDR A:0x61e04bd4
y.create.l HWIO_TCU_APPS_SMMU_SSD_REG_758_APPS_ADDR A:0x61e04bd8
y.create.l HWIO_TCU_APPS_SMMU_SSD_REG_759_APPS_ADDR A:0x61e04bdc
y.create.l HWIO_TCU_APPS_SMMU_SSD_REG_760_APPS_ADDR A:0x61e04be0
y.create.l HWIO_TCU_APPS_SMMU_SSD_REG_761_APPS_ADDR A:0x61e04be4
y.create.l HWIO_TCU_APPS_SMMU_SSD_REG_762_APPS_ADDR A:0x61e04be8
y.create.l HWIO_TCU_APPS_SMMU_SSD_REG_763_APPS_ADDR A:0x61e04bec
y.create.l HWIO_TCU_APPS_SMMU_SSD_REG_764_APPS_ADDR A:0x61e04bf0
y.create.l HWIO_TCU_APPS_SMMU_SSD_REG_765_APPS_ADDR A:0x61e04bf4
y.create.l HWIO_TCU_APPS_SMMU_SSD_REG_766_APPS_ADDR A:0x61e04bf8
y.create.l HWIO_TCU_APPS_SMMU_SSD_REG_767_APPS_ADDR A:0x61e04bfc
y.create.l HWIO_TCU_APPS_SMMU_SSD_REG_768_APPS_ADDR A:0x61e04c00
y.create.l HWIO_TCU_APPS_SMMU_SSD_REG_769_APPS_ADDR A:0x61e04c04
y.create.l HWIO_TCU_APPS_SMMU_SSD_REG_770_APPS_ADDR A:0x61e04c08
y.create.l HWIO_TCU_APPS_SMMU_SSD_REG_771_APPS_ADDR A:0x61e04c0c
y.create.l HWIO_TCU_APPS_SMMU_SSD_REG_772_APPS_ADDR A:0x61e04c10
y.create.l HWIO_TCU_APPS_SMMU_SSD_REG_773_APPS_ADDR A:0x61e04c14
y.create.l HWIO_TCU_APPS_SMMU_SSD_REG_774_APPS_ADDR A:0x61e04c18
y.create.l HWIO_TCU_APPS_SMMU_SSD_REG_775_APPS_ADDR A:0x61e04c1c
y.create.l HWIO_TCU_APPS_SMMU_SSD_REG_776_APPS_ADDR A:0x61e04c20
y.create.l HWIO_TCU_APPS_SMMU_SSD_REG_777_APPS_ADDR A:0x61e04c24
y.create.l HWIO_TCU_APPS_SMMU_SSD_REG_778_APPS_ADDR A:0x61e04c28
y.create.l HWIO_TCU_APPS_SMMU_SSD_REG_779_APPS_ADDR A:0x61e04c2c
y.create.l HWIO_TCU_APPS_SMMU_SSD_REG_780_APPS_ADDR A:0x61e04c30
y.create.l HWIO_TCU_APPS_SMMU_SSD_REG_781_APPS_ADDR A:0x61e04c34
y.create.l HWIO_TCU_APPS_SMMU_SSD_REG_782_APPS_ADDR A:0x61e04c38
y.create.l HWIO_TCU_APPS_SMMU_SSD_REG_783_APPS_ADDR A:0x61e04c3c
y.create.l HWIO_TCU_APPS_SMMU_SSD_REG_784_APPS_ADDR A:0x61e04c40
y.create.l HWIO_TCU_APPS_SMMU_SSD_REG_785_APPS_ADDR A:0x61e04c44
y.create.l HWIO_TCU_APPS_SMMU_SSD_REG_786_APPS_ADDR A:0x61e04c48
y.create.l HWIO_TCU_APPS_SMMU_SSD_REG_787_APPS_ADDR A:0x61e04c4c
y.create.l HWIO_TCU_APPS_SMMU_SSD_REG_788_APPS_ADDR A:0x61e04c50
y.create.l HWIO_TCU_APPS_SMMU_SSD_REG_789_APPS_ADDR A:0x61e04c54
y.create.l HWIO_TCU_APPS_SMMU_SSD_REG_790_APPS_ADDR A:0x61e04c58
y.create.l HWIO_TCU_APPS_SMMU_SSD_REG_791_APPS_ADDR A:0x61e04c5c
y.create.l HWIO_TCU_APPS_SMMU_SSD_REG_792_APPS_ADDR A:0x61e04c60
y.create.l HWIO_TCU_APPS_SMMU_SSD_REG_793_APPS_ADDR A:0x61e04c64
y.create.l HWIO_TCU_APPS_SMMU_SSD_REG_794_APPS_ADDR A:0x61e04c68
y.create.l HWIO_TCU_APPS_SMMU_SSD_REG_795_APPS_ADDR A:0x61e04c6c
y.create.l HWIO_TCU_APPS_SMMU_SSD_REG_796_APPS_ADDR A:0x61e04c70
y.create.l HWIO_TCU_APPS_SMMU_SSD_REG_797_APPS_ADDR A:0x61e04c74
y.create.l HWIO_TCU_APPS_SMMU_SSD_REG_798_APPS_ADDR A:0x61e04c78
y.create.l HWIO_TCU_APPS_SMMU_SSD_REG_799_APPS_ADDR A:0x61e04c7c
y.create.l HWIO_TCU_APPS_SMMU_SSD_REG_800_APPS_ADDR A:0x61e04c80
y.create.l HWIO_TCU_APPS_SMMU_SSD_REG_801_APPS_ADDR A:0x61e04c84
y.create.l HWIO_TCU_APPS_SMMU_SSD_REG_802_APPS_ADDR A:0x61e04c88
y.create.l HWIO_TCU_APPS_SMMU_SSD_REG_803_APPS_ADDR A:0x61e04c8c
y.create.l HWIO_TCU_APPS_SMMU_SSD_REG_804_APPS_ADDR A:0x61e04c90
y.create.l HWIO_TCU_APPS_SMMU_SSD_REG_805_APPS_ADDR A:0x61e04c94
y.create.l HWIO_TCU_APPS_SMMU_SSD_REG_806_APPS_ADDR A:0x61e04c98
y.create.l HWIO_TCU_APPS_SMMU_SSD_REG_807_APPS_ADDR A:0x61e04c9c
y.create.l HWIO_TCU_APPS_SMMU_SSD_REG_808_APPS_ADDR A:0x61e04ca0
y.create.l HWIO_TCU_APPS_SMMU_SSD_REG_809_APPS_ADDR A:0x61e04ca4
y.create.l HWIO_TCU_APPS_SMMU_SSD_REG_810_APPS_ADDR A:0x61e04ca8
y.create.l HWIO_TCU_APPS_SMMU_SSD_REG_811_APPS_ADDR A:0x61e04cac
y.create.l HWIO_TCU_APPS_SMMU_SSD_REG_812_APPS_ADDR A:0x61e04cb0
y.create.l HWIO_TCU_APPS_SMMU_SSD_REG_813_APPS_ADDR A:0x61e04cb4
y.create.l HWIO_TCU_APPS_SMMU_SSD_REG_814_APPS_ADDR A:0x61e04cb8
y.create.l HWIO_TCU_APPS_SMMU_SSD_REG_815_APPS_ADDR A:0x61e04cbc
y.create.l HWIO_TCU_APPS_SMMU_SSD_REG_816_APPS_ADDR A:0x61e04cc0
y.create.l HWIO_TCU_APPS_SMMU_SSD_REG_817_APPS_ADDR A:0x61e04cc4
y.create.l HWIO_TCU_APPS_SMMU_SSD_REG_818_APPS_ADDR A:0x61e04cc8
y.create.l HWIO_TCU_APPS_SMMU_SSD_REG_819_APPS_ADDR A:0x61e04ccc
y.create.l HWIO_TCU_APPS_SMMU_SSD_REG_820_APPS_ADDR A:0x61e04cd0
y.create.l HWIO_TCU_APPS_SMMU_SSD_REG_821_APPS_ADDR A:0x61e04cd4
y.create.l HWIO_TCU_APPS_SMMU_SSD_REG_822_APPS_ADDR A:0x61e04cd8
y.create.l HWIO_TCU_APPS_SMMU_SSD_REG_823_APPS_ADDR A:0x61e04cdc
y.create.l HWIO_TCU_APPS_SMMU_SSD_REG_824_APPS_ADDR A:0x61e04ce0
y.create.l HWIO_TCU_APPS_SMMU_SSD_REG_825_APPS_ADDR A:0x61e04ce4
y.create.l HWIO_TCU_APPS_SMMU_SSD_REG_826_APPS_ADDR A:0x61e04ce8
y.create.l HWIO_TCU_APPS_SMMU_SSD_REG_827_APPS_ADDR A:0x61e04cec
y.create.l HWIO_TCU_APPS_SMMU_SSD_REG_828_APPS_ADDR A:0x61e04cf0
y.create.l HWIO_TCU_APPS_SMMU_SSD_REG_829_APPS_ADDR A:0x61e04cf4
y.create.l HWIO_TCU_APPS_SMMU_SSD_REG_830_APPS_ADDR A:0x61e04cf8
y.create.l HWIO_TCU_APPS_SMMU_SSD_REG_831_APPS_ADDR A:0x61e04cfc
y.create.l HWIO_TCU_APPS_SMMU_SSD_REG_832_APPS_ADDR A:0x61e04d00
y.create.l HWIO_TCU_APPS_SMMU_SSD_REG_833_APPS_ADDR A:0x61e04d04
y.create.l HWIO_TCU_APPS_SMMU_SSD_REG_834_APPS_ADDR A:0x61e04d08
y.create.l HWIO_TCU_APPS_SMMU_SSD_REG_835_APPS_ADDR A:0x61e04d0c
y.create.l HWIO_TCU_APPS_SMMU_SSD_REG_836_APPS_ADDR A:0x61e04d10
y.create.l HWIO_TCU_APPS_SMMU_SSD_REG_837_APPS_ADDR A:0x61e04d14
y.create.l HWIO_TCU_APPS_SMMU_SSD_REG_838_APPS_ADDR A:0x61e04d18
y.create.l HWIO_TCU_APPS_SMMU_SSD_REG_839_APPS_ADDR A:0x61e04d1c
y.create.l HWIO_TCU_APPS_SMMU_SSD_REG_840_APPS_ADDR A:0x61e04d20
y.create.l HWIO_TCU_APPS_SMMU_SSD_REG_841_APPS_ADDR A:0x61e04d24
y.create.l HWIO_TCU_APPS_SMMU_SSD_REG_842_APPS_ADDR A:0x61e04d28
y.create.l HWIO_TCU_APPS_SMMU_SSD_REG_843_APPS_ADDR A:0x61e04d2c
y.create.l HWIO_TCU_APPS_SMMU_SSD_REG_844_APPS_ADDR A:0x61e04d30
y.create.l HWIO_TCU_APPS_SMMU_SSD_REG_845_APPS_ADDR A:0x61e04d34
y.create.l HWIO_TCU_APPS_SMMU_SSD_REG_846_APPS_ADDR A:0x61e04d38
y.create.l HWIO_TCU_APPS_SMMU_SSD_REG_847_APPS_ADDR A:0x61e04d3c
y.create.l HWIO_TCU_APPS_SMMU_SSD_REG_848_APPS_ADDR A:0x61e04d40
y.create.l HWIO_TCU_APPS_SMMU_SSD_REG_849_APPS_ADDR A:0x61e04d44
y.create.l HWIO_TCU_APPS_SMMU_SSD_REG_850_APPS_ADDR A:0x61e04d48
y.create.l HWIO_TCU_APPS_SMMU_SSD_REG_851_APPS_ADDR A:0x61e04d4c
y.create.l HWIO_TCU_APPS_SMMU_SSD_REG_852_APPS_ADDR A:0x61e04d50
y.create.l HWIO_TCU_APPS_SMMU_SSD_REG_853_APPS_ADDR A:0x61e04d54
y.create.l HWIO_TCU_APPS_SMMU_SSD_REG_854_APPS_ADDR A:0x61e04d58
y.create.l HWIO_TCU_APPS_SMMU_SSD_REG_855_APPS_ADDR A:0x61e04d5c
y.create.l HWIO_TCU_APPS_SMMU_SSD_REG_856_APPS_ADDR A:0x61e04d60
y.create.l HWIO_TCU_APPS_SMMU_SSD_REG_857_APPS_ADDR A:0x61e04d64
y.create.l HWIO_TCU_APPS_SMMU_SSD_REG_858_APPS_ADDR A:0x61e04d68
y.create.l HWIO_TCU_APPS_SMMU_SSD_REG_859_APPS_ADDR A:0x61e04d6c
y.create.l HWIO_TCU_APPS_SMMU_SSD_REG_860_APPS_ADDR A:0x61e04d70
y.create.l HWIO_TCU_APPS_SMMU_SSD_REG_861_APPS_ADDR A:0x61e04d74
y.create.l HWIO_TCU_APPS_SMMU_SSD_REG_862_APPS_ADDR A:0x61e04d78
y.create.l HWIO_TCU_APPS_SMMU_SSD_REG_863_APPS_ADDR A:0x61e04d7c
y.create.l HWIO_TCU_APPS_SMMU_SSD_REG_864_APPS_ADDR A:0x61e04d80
y.create.l HWIO_TCU_APPS_SMMU_SSD_REG_865_APPS_ADDR A:0x61e04d84
y.create.l HWIO_TCU_APPS_SMMU_SSD_REG_866_APPS_ADDR A:0x61e04d88
y.create.l HWIO_TCU_APPS_SMMU_SSD_REG_867_APPS_ADDR A:0x61e04d8c
y.create.l HWIO_TCU_APPS_SMMU_SSD_REG_868_APPS_ADDR A:0x61e04d90
y.create.l HWIO_TCU_APPS_SMMU_SSD_REG_869_APPS_ADDR A:0x61e04d94
y.create.l HWIO_TCU_APPS_SMMU_SSD_REG_870_APPS_ADDR A:0x61e04d98
y.create.l HWIO_TCU_APPS_SMMU_SSD_REG_871_APPS_ADDR A:0x61e04d9c
y.create.l HWIO_TCU_APPS_SMMU_SSD_REG_872_APPS_ADDR A:0x61e04da0
y.create.l HWIO_TCU_APPS_SMMU_SSD_REG_873_APPS_ADDR A:0x61e04da4
y.create.l HWIO_TCU_APPS_SMMU_SSD_REG_874_APPS_ADDR A:0x61e04da8
y.create.l HWIO_TCU_APPS_SMMU_SSD_REG_875_APPS_ADDR A:0x61e04dac
y.create.l HWIO_TCU_APPS_SMMU_SSD_REG_876_APPS_ADDR A:0x61e04db0
y.create.l HWIO_TCU_APPS_SMMU_SSD_REG_877_APPS_ADDR A:0x61e04db4
y.create.l HWIO_TCU_APPS_SMMU_SSD_REG_878_APPS_ADDR A:0x61e04db8
y.create.l HWIO_TCU_APPS_SMMU_SSD_REG_879_APPS_ADDR A:0x61e04dbc
y.create.l HWIO_TCU_APPS_SMMU_SSD_REG_880_APPS_ADDR A:0x61e04dc0
y.create.l HWIO_TCU_APPS_SMMU_SSD_REG_881_APPS_ADDR A:0x61e04dc4
y.create.l HWIO_TCU_APPS_SMMU_SSD_REG_882_APPS_ADDR A:0x61e04dc8
y.create.l HWIO_TCU_APPS_SMMU_SSD_REG_883_APPS_ADDR A:0x61e04dcc
y.create.l HWIO_TCU_APPS_SMMU_SSD_REG_884_APPS_ADDR A:0x61e04dd0
y.create.l HWIO_TCU_APPS_SMMU_SSD_REG_885_APPS_ADDR A:0x61e04dd4
y.create.l HWIO_TCU_APPS_SMMU_SSD_REG_886_APPS_ADDR A:0x61e04dd8
y.create.l HWIO_TCU_APPS_SMMU_SSD_REG_887_APPS_ADDR A:0x61e04ddc
y.create.l HWIO_TCU_APPS_SMMU_SSD_REG_888_APPS_ADDR A:0x61e04de0
y.create.l HWIO_TCU_APPS_SMMU_SSD_REG_889_APPS_ADDR A:0x61e04de4
y.create.l HWIO_TCU_APPS_SMMU_SSD_REG_890_APPS_ADDR A:0x61e04de8
y.create.l HWIO_TCU_APPS_SMMU_SSD_REG_891_APPS_ADDR A:0x61e04dec
y.create.l HWIO_TCU_APPS_SMMU_SSD_REG_892_APPS_ADDR A:0x61e04df0
y.create.l HWIO_TCU_APPS_SMMU_SSD_REG_893_APPS_ADDR A:0x61e04df4
y.create.l HWIO_TCU_APPS_SMMU_SSD_REG_894_APPS_ADDR A:0x61e04df8
y.create.l HWIO_TCU_APPS_SMMU_SSD_REG_895_APPS_ADDR A:0x61e04dfc
y.create.l HWIO_TCU_APPS_SMMU_SSD_REG_896_APPS_ADDR A:0x61e04e00
y.create.l HWIO_TCU_APPS_SMMU_SSD_REG_897_APPS_ADDR A:0x61e04e04
y.create.l HWIO_TCU_APPS_SMMU_SSD_REG_898_APPS_ADDR A:0x61e04e08
y.create.l HWIO_TCU_APPS_SMMU_SSD_REG_899_APPS_ADDR A:0x61e04e0c
y.create.l HWIO_TCU_APPS_SMMU_SSD_REG_900_APPS_ADDR A:0x61e04e10
y.create.l HWIO_TCU_APPS_SMMU_SSD_REG_901_APPS_ADDR A:0x61e04e14
y.create.l HWIO_TCU_APPS_SMMU_SSD_REG_902_APPS_ADDR A:0x61e04e18
y.create.l HWIO_TCU_APPS_SMMU_SSD_REG_903_APPS_ADDR A:0x61e04e1c
y.create.l HWIO_TCU_APPS_SMMU_SSD_REG_904_APPS_ADDR A:0x61e04e20
y.create.l HWIO_TCU_APPS_SMMU_SSD_REG_905_APPS_ADDR A:0x61e04e24
y.create.l HWIO_TCU_APPS_SMMU_SSD_REG_906_APPS_ADDR A:0x61e04e28
y.create.l HWIO_TCU_APPS_SMMU_SSD_REG_907_APPS_ADDR A:0x61e04e2c
y.create.l HWIO_TCU_APPS_SMMU_SSD_REG_908_APPS_ADDR A:0x61e04e30
y.create.l HWIO_TCU_APPS_SMMU_SSD_REG_909_APPS_ADDR A:0x61e04e34
y.create.l HWIO_TCU_APPS_SMMU_SSD_REG_910_APPS_ADDR A:0x61e04e38
y.create.l HWIO_TCU_APPS_SMMU_SSD_REG_911_APPS_ADDR A:0x61e04e3c
y.create.l HWIO_TCU_APPS_SMMU_SSD_REG_912_APPS_ADDR A:0x61e04e40
y.create.l HWIO_TCU_APPS_SMMU_SSD_REG_913_APPS_ADDR A:0x61e04e44
y.create.l HWIO_TCU_APPS_SMMU_SSD_REG_914_APPS_ADDR A:0x61e04e48
y.create.l HWIO_TCU_APPS_SMMU_SSD_REG_915_APPS_ADDR A:0x61e04e4c
y.create.l HWIO_TCU_APPS_SMMU_SSD_REG_916_APPS_ADDR A:0x61e04e50
y.create.l HWIO_TCU_APPS_SMMU_SSD_REG_917_APPS_ADDR A:0x61e04e54
y.create.l HWIO_TCU_APPS_SMMU_SSD_REG_918_APPS_ADDR A:0x61e04e58
y.create.l HWIO_TCU_APPS_SMMU_SSD_REG_919_APPS_ADDR A:0x61e04e5c
y.create.l HWIO_TCU_APPS_SMMU_SSD_REG_920_APPS_ADDR A:0x61e04e60
y.create.l HWIO_TCU_APPS_SMMU_SSD_REG_921_APPS_ADDR A:0x61e04e64
y.create.l HWIO_TCU_APPS_SMMU_SSD_REG_922_APPS_ADDR A:0x61e04e68
y.create.l HWIO_TCU_APPS_SMMU_SSD_REG_923_APPS_ADDR A:0x61e04e6c
y.create.l HWIO_TCU_APPS_SMMU_SSD_REG_924_APPS_ADDR A:0x61e04e70
y.create.l HWIO_TCU_APPS_SMMU_SSD_REG_925_APPS_ADDR A:0x61e04e74
y.create.l HWIO_TCU_APPS_SMMU_SSD_REG_926_APPS_ADDR A:0x61e04e78
y.create.l HWIO_TCU_APPS_SMMU_SSD_REG_927_APPS_ADDR A:0x61e04e7c
y.create.l HWIO_TCU_APPS_SMMU_SSD_REG_928_APPS_ADDR A:0x61e04e80
y.create.l HWIO_TCU_APPS_SMMU_SSD_REG_929_APPS_ADDR A:0x61e04e84
y.create.l HWIO_TCU_APPS_SMMU_SSD_REG_930_APPS_ADDR A:0x61e04e88
y.create.l HWIO_TCU_APPS_SMMU_SSD_REG_931_APPS_ADDR A:0x61e04e8c
y.create.l HWIO_TCU_APPS_SMMU_SSD_REG_932_APPS_ADDR A:0x61e04e90
y.create.l HWIO_TCU_APPS_SMMU_SSD_REG_933_APPS_ADDR A:0x61e04e94
y.create.l HWIO_TCU_APPS_SMMU_SSD_REG_934_APPS_ADDR A:0x61e04e98
y.create.l HWIO_TCU_APPS_SMMU_SSD_REG_935_APPS_ADDR A:0x61e04e9c
y.create.l HWIO_TCU_APPS_SMMU_SSD_REG_936_APPS_ADDR A:0x61e04ea0
y.create.l HWIO_TCU_APPS_SMMU_SSD_REG_937_APPS_ADDR A:0x61e04ea4
y.create.l HWIO_TCU_APPS_SMMU_SSD_REG_938_APPS_ADDR A:0x61e04ea8
y.create.l HWIO_TCU_APPS_SMMU_SSD_REG_939_APPS_ADDR A:0x61e04eac
y.create.l HWIO_TCU_APPS_SMMU_SSD_REG_940_APPS_ADDR A:0x61e04eb0
y.create.l HWIO_TCU_APPS_SMMU_SSD_REG_941_APPS_ADDR A:0x61e04eb4
y.create.l HWIO_TCU_APPS_SMMU_SSD_REG_942_APPS_ADDR A:0x61e04eb8
y.create.l HWIO_TCU_APPS_SMMU_SSD_REG_943_APPS_ADDR A:0x61e04ebc
y.create.l HWIO_TCU_APPS_SMMU_SSD_REG_944_APPS_ADDR A:0x61e04ec0
y.create.l HWIO_TCU_APPS_SMMU_SSD_REG_945_APPS_ADDR A:0x61e04ec4
y.create.l HWIO_TCU_APPS_SMMU_SSD_REG_946_APPS_ADDR A:0x61e04ec8
y.create.l HWIO_TCU_APPS_SMMU_SSD_REG_947_APPS_ADDR A:0x61e04ecc
y.create.l HWIO_TCU_APPS_SMMU_SSD_REG_948_APPS_ADDR A:0x61e04ed0
y.create.l HWIO_TCU_APPS_SMMU_SSD_REG_949_APPS_ADDR A:0x61e04ed4
y.create.l HWIO_TCU_APPS_SMMU_SSD_REG_950_APPS_ADDR A:0x61e04ed8
y.create.l HWIO_TCU_APPS_SMMU_SSD_REG_951_APPS_ADDR A:0x61e04edc
y.create.l HWIO_TCU_APPS_SMMU_SSD_REG_952_APPS_ADDR A:0x61e04ee0
y.create.l HWIO_TCU_APPS_SMMU_SSD_REG_953_APPS_ADDR A:0x61e04ee4
y.create.l HWIO_TCU_APPS_SMMU_SSD_REG_954_APPS_ADDR A:0x61e04ee8
y.create.l HWIO_TCU_APPS_SMMU_SSD_REG_955_APPS_ADDR A:0x61e04eec
y.create.l HWIO_TCU_APPS_SMMU_SSD_REG_956_APPS_ADDR A:0x61e04ef0
y.create.l HWIO_TCU_APPS_SMMU_SSD_REG_957_APPS_ADDR A:0x61e04ef4
y.create.l HWIO_TCU_APPS_SMMU_SSD_REG_958_APPS_ADDR A:0x61e04ef8
y.create.l HWIO_TCU_APPS_SMMU_SSD_REG_959_APPS_ADDR A:0x61e04efc
y.create.l HWIO_TCU_APPS_SMMU_SSD_REG_960_APPS_ADDR A:0x61e04f00
y.create.l HWIO_TCU_APPS_SMMU_SSD_REG_961_APPS_ADDR A:0x61e04f04
y.create.l HWIO_TCU_APPS_SMMU_SSD_REG_962_APPS_ADDR A:0x61e04f08
y.create.l HWIO_TCU_APPS_SMMU_SSD_REG_963_APPS_ADDR A:0x61e04f0c
y.create.l HWIO_TCU_APPS_SMMU_SSD_REG_964_APPS_ADDR A:0x61e04f10
y.create.l HWIO_TCU_APPS_SMMU_SSD_REG_965_APPS_ADDR A:0x61e04f14
y.create.l HWIO_TCU_APPS_SMMU_SSD_REG_966_APPS_ADDR A:0x61e04f18
y.create.l HWIO_TCU_APPS_SMMU_SSD_REG_967_APPS_ADDR A:0x61e04f1c
y.create.l HWIO_TCU_APPS_SMMU_SSD_REG_968_APPS_ADDR A:0x61e04f20
y.create.l HWIO_TCU_APPS_SMMU_SSD_REG_969_APPS_ADDR A:0x61e04f24
y.create.l HWIO_TCU_APPS_SMMU_SSD_REG_970_APPS_ADDR A:0x61e04f28
y.create.l HWIO_TCU_APPS_SMMU_SSD_REG_971_APPS_ADDR A:0x61e04f2c
y.create.l HWIO_TCU_APPS_SMMU_SSD_REG_972_APPS_ADDR A:0x61e04f30
y.create.l HWIO_TCU_APPS_SMMU_SSD_REG_973_APPS_ADDR A:0x61e04f34
y.create.l HWIO_TCU_APPS_SMMU_SSD_REG_974_APPS_ADDR A:0x61e04f38
y.create.l HWIO_TCU_APPS_SMMU_SSD_REG_975_APPS_ADDR A:0x61e04f3c
y.create.l HWIO_TCU_APPS_SMMU_SSD_REG_976_APPS_ADDR A:0x61e04f40
y.create.l HWIO_TCU_APPS_SMMU_SSD_REG_977_APPS_ADDR A:0x61e04f44
y.create.l HWIO_TCU_APPS_SMMU_SSD_REG_978_APPS_ADDR A:0x61e04f48
y.create.l HWIO_TCU_APPS_SMMU_SSD_REG_979_APPS_ADDR A:0x61e04f4c
y.create.l HWIO_TCU_APPS_SMMU_SSD_REG_980_APPS_ADDR A:0x61e04f50
y.create.l HWIO_TCU_APPS_SMMU_SSD_REG_981_APPS_ADDR A:0x61e04f54
y.create.l HWIO_TCU_APPS_SMMU_SSD_REG_982_APPS_ADDR A:0x61e04f58
y.create.l HWIO_TCU_APPS_SMMU_SSD_REG_983_APPS_ADDR A:0x61e04f5c
y.create.l HWIO_TCU_APPS_SMMU_SSD_REG_984_APPS_ADDR A:0x61e04f60
y.create.l HWIO_TCU_APPS_SMMU_SSD_REG_985_APPS_ADDR A:0x61e04f64
y.create.l HWIO_TCU_APPS_SMMU_SSD_REG_986_APPS_ADDR A:0x61e04f68
y.create.l HWIO_TCU_APPS_SMMU_SSD_REG_987_APPS_ADDR A:0x61e04f6c
y.create.l HWIO_TCU_APPS_SMMU_SSD_REG_988_APPS_ADDR A:0x61e04f70
y.create.l HWIO_TCU_APPS_SMMU_SSD_REG_989_APPS_ADDR A:0x61e04f74
y.create.l HWIO_TCU_APPS_SMMU_SSD_REG_990_APPS_ADDR A:0x61e04f78
y.create.l HWIO_TCU_APPS_SMMU_SSD_REG_991_APPS_ADDR A:0x61e04f7c
y.create.l HWIO_TCU_APPS_SMMU_SSD_REG_992_APPS_ADDR A:0x61e04f80
y.create.l HWIO_TCU_APPS_SMMU_SSD_REG_993_APPS_ADDR A:0x61e04f84
y.create.l HWIO_TCU_APPS_SMMU_SSD_REG_994_APPS_ADDR A:0x61e04f88
y.create.l HWIO_TCU_APPS_SMMU_SSD_REG_995_APPS_ADDR A:0x61e04f8c
y.create.l HWIO_TCU_APPS_SMMU_SSD_REG_996_APPS_ADDR A:0x61e04f90
y.create.l HWIO_TCU_APPS_SMMU_SSD_REG_997_APPS_ADDR A:0x61e04f94
y.create.l HWIO_TCU_APPS_SMMU_SSD_REG_998_APPS_ADDR A:0x61e04f98
y.create.l HWIO_TCU_APPS_SMMU_SSD_REG_999_APPS_ADDR A:0x61e04f9c
y.create.l HWIO_TCU_APPS_SMMU_SSD_REG_1000_APPS_ADDR A:0x61e04fa0
y.create.l HWIO_TCU_APPS_SMMU_SSD_REG_1001_APPS_ADDR A:0x61e04fa4
y.create.l HWIO_TCU_APPS_SMMU_SSD_REG_1002_APPS_ADDR A:0x61e04fa8
y.create.l HWIO_TCU_APPS_SMMU_SSD_REG_1003_APPS_ADDR A:0x61e04fac
y.create.l HWIO_TCU_APPS_SMMU_SSD_REG_1004_APPS_ADDR A:0x61e04fb0
y.create.l HWIO_TCU_APPS_SMMU_SSD_REG_1005_APPS_ADDR A:0x61e04fb4
y.create.l HWIO_TCU_APPS_SMMU_SSD_REG_1006_APPS_ADDR A:0x61e04fb8
y.create.l HWIO_TCU_APPS_SMMU_SSD_REG_1007_APPS_ADDR A:0x61e04fbc
y.create.l HWIO_TCU_APPS_SMMU_SSD_REG_1008_APPS_ADDR A:0x61e04fc0
y.create.l HWIO_TCU_APPS_SMMU_SSD_REG_1009_APPS_ADDR A:0x61e04fc4
y.create.l HWIO_TCU_APPS_SMMU_SSD_REG_1010_APPS_ADDR A:0x61e04fc8
y.create.l HWIO_TCU_APPS_SMMU_SSD_REG_1011_APPS_ADDR A:0x61e04fcc
y.create.l HWIO_TCU_APPS_SMMU_SSD_REG_1012_APPS_ADDR A:0x61e04fd0
y.create.l HWIO_TCU_APPS_SMMU_SSD_REG_1013_APPS_ADDR A:0x61e04fd4
y.create.l HWIO_TCU_APPS_SMMU_SSD_REG_1014_APPS_ADDR A:0x61e04fd8
y.create.l HWIO_TCU_APPS_SMMU_SSD_REG_1015_APPS_ADDR A:0x61e04fdc
y.create.l HWIO_TCU_APPS_SMMU_SSD_REG_1016_APPS_ADDR A:0x61e04fe0
y.create.l HWIO_TCU_APPS_SMMU_SSD_REG_1017_APPS_ADDR A:0x61e04fe4
y.create.l HWIO_TCU_APPS_SMMU_SSD_REG_1018_APPS_ADDR A:0x61e04fe8
y.create.l HWIO_TCU_APPS_SMMU_SSD_REG_1019_APPS_ADDR A:0x61e04fec
y.create.l HWIO_TCU_APPS_SMMU_SSD_REG_1020_APPS_ADDR A:0x61e04ff0
y.create.l HWIO_TCU_APPS_SMMU_SSD_REG_1021_APPS_ADDR A:0x61e04ff4
y.create.l HWIO_TCU_APPS_SMMU_SSD_REG_1022_APPS_ADDR A:0x61e04ff8
y.create.l HWIO_TCU_APPS_SMMU_SSD_REG_1023_APPS_ADDR A:0x61e04ffc
y.create.l HWIO_TCU_APPS_SMMU_CB0_SCTLR_APPS_ADDR A:0x61e10000
y.create.l HWIO_TCU_APPS_SMMU_CB1_SCTLR_APPS_ADDR A:0x61e11000
y.create.l HWIO_TCU_APPS_SMMU_CB2_SCTLR_APPS_ADDR A:0x61e12000
y.create.l HWIO_TCU_APPS_SMMU_CB3_SCTLR_APPS_ADDR A:0x61e13000
y.create.l HWIO_TCU_APPS_SMMU_CB4_SCTLR_APPS_ADDR A:0x61e14000
y.create.l HWIO_TCU_APPS_SMMU_CB5_SCTLR_APPS_ADDR A:0x61e15000
y.create.l HWIO_TCU_APPS_SMMU_CB6_SCTLR_APPS_ADDR A:0x61e16000
y.create.l HWIO_TCU_APPS_SMMU_CB7_SCTLR_APPS_ADDR A:0x61e17000
y.create.l HWIO_TCU_APPS_SMMU_CB8_SCTLR_APPS_ADDR A:0x61e18000
y.create.l HWIO_TCU_APPS_SMMU_CB9_SCTLR_APPS_ADDR A:0x61e19000
y.create.l HWIO_TCU_APPS_SMMU_CB10_SCTLR_APPS_ADDR A:0x61e1a000
y.create.l HWIO_TCU_APPS_SMMU_CB11_SCTLR_APPS_ADDR A:0x61e1b000
y.create.l HWIO_TCU_APPS_SMMU_CB12_SCTLR_APPS_ADDR A:0x61e1c000
y.create.l HWIO_TCU_APPS_SMMU_CB13_SCTLR_APPS_ADDR A:0x61e1d000
y.create.l HWIO_TCU_APPS_SMMU_CB14_SCTLR_APPS_ADDR A:0x61e1e000
y.create.l HWIO_TCU_APPS_SMMU_CB15_SCTLR_APPS_ADDR A:0x61e1f000
y.create.l HWIO_TCU_APPS_SMMU_CB0_ACTLR_APPS_ADDR A:0x61e10004
y.create.l HWIO_TCU_APPS_SMMU_CB1_ACTLR_APPS_ADDR A:0x61e11004
y.create.l HWIO_TCU_APPS_SMMU_CB2_ACTLR_APPS_ADDR A:0x61e12004
y.create.l HWIO_TCU_APPS_SMMU_CB3_ACTLR_APPS_ADDR A:0x61e13004
y.create.l HWIO_TCU_APPS_SMMU_CB4_ACTLR_APPS_ADDR A:0x61e14004
y.create.l HWIO_TCU_APPS_SMMU_CB5_ACTLR_APPS_ADDR A:0x61e15004
y.create.l HWIO_TCU_APPS_SMMU_CB6_ACTLR_APPS_ADDR A:0x61e16004
y.create.l HWIO_TCU_APPS_SMMU_CB7_ACTLR_APPS_ADDR A:0x61e17004
y.create.l HWIO_TCU_APPS_SMMU_CB8_ACTLR_APPS_ADDR A:0x61e18004
y.create.l HWIO_TCU_APPS_SMMU_CB9_ACTLR_APPS_ADDR A:0x61e19004
y.create.l HWIO_TCU_APPS_SMMU_CB10_ACTLR_APPS_ADDR A:0x61e1a004
y.create.l HWIO_TCU_APPS_SMMU_CB11_ACTLR_APPS_ADDR A:0x61e1b004
y.create.l HWIO_TCU_APPS_SMMU_CB12_ACTLR_APPS_ADDR A:0x61e1c004
y.create.l HWIO_TCU_APPS_SMMU_CB13_ACTLR_APPS_ADDR A:0x61e1d004
y.create.l HWIO_TCU_APPS_SMMU_CB14_ACTLR_APPS_ADDR A:0x61e1e004
y.create.l HWIO_TCU_APPS_SMMU_CB15_ACTLR_APPS_ADDR A:0x61e1f004
y.create.l HWIO_TCU_APPS_SMMU_CB0_RESUME_APPS_ADDR A:0x61e10008
y.create.l HWIO_TCU_APPS_SMMU_CB1_RESUME_APPS_ADDR A:0x61e11008
y.create.l HWIO_TCU_APPS_SMMU_CB2_RESUME_APPS_ADDR A:0x61e12008
y.create.l HWIO_TCU_APPS_SMMU_CB3_RESUME_APPS_ADDR A:0x61e13008
y.create.l HWIO_TCU_APPS_SMMU_CB4_RESUME_APPS_ADDR A:0x61e14008
y.create.l HWIO_TCU_APPS_SMMU_CB5_RESUME_APPS_ADDR A:0x61e15008
y.create.l HWIO_TCU_APPS_SMMU_CB6_RESUME_APPS_ADDR A:0x61e16008
y.create.l HWIO_TCU_APPS_SMMU_CB7_RESUME_APPS_ADDR A:0x61e17008
y.create.l HWIO_TCU_APPS_SMMU_CB8_RESUME_APPS_ADDR A:0x61e18008
y.create.l HWIO_TCU_APPS_SMMU_CB9_RESUME_APPS_ADDR A:0x61e19008
y.create.l HWIO_TCU_APPS_SMMU_CB10_RESUME_APPS_ADDR A:0x61e1a008
y.create.l HWIO_TCU_APPS_SMMU_CB11_RESUME_APPS_ADDR A:0x61e1b008
y.create.l HWIO_TCU_APPS_SMMU_CB12_RESUME_APPS_ADDR A:0x61e1c008
y.create.l HWIO_TCU_APPS_SMMU_CB13_RESUME_APPS_ADDR A:0x61e1d008
y.create.l HWIO_TCU_APPS_SMMU_CB14_RESUME_APPS_ADDR A:0x61e1e008
y.create.l HWIO_TCU_APPS_SMMU_CB15_RESUME_APPS_ADDR A:0x61e1f008
y.create.l HWIO_TCU_APPS_SMMU_CB0_TTBCR2_APPS_ADDR A:0x61e10010
y.create.l HWIO_TCU_APPS_SMMU_CB1_TTBCR2_APPS_ADDR A:0x61e11010
y.create.l HWIO_TCU_APPS_SMMU_CB2_TTBCR2_APPS_ADDR A:0x61e12010
y.create.l HWIO_TCU_APPS_SMMU_CB3_TTBCR2_APPS_ADDR A:0x61e13010
y.create.l HWIO_TCU_APPS_SMMU_CB4_TTBCR2_APPS_ADDR A:0x61e14010
y.create.l HWIO_TCU_APPS_SMMU_CB5_TTBCR2_APPS_ADDR A:0x61e15010
y.create.l HWIO_TCU_APPS_SMMU_CB6_TTBCR2_APPS_ADDR A:0x61e16010
y.create.l HWIO_TCU_APPS_SMMU_CB7_TTBCR2_APPS_ADDR A:0x61e17010
y.create.l HWIO_TCU_APPS_SMMU_CB8_TTBCR2_APPS_ADDR A:0x61e18010
y.create.l HWIO_TCU_APPS_SMMU_CB9_TTBCR2_APPS_ADDR A:0x61e19010
y.create.l HWIO_TCU_APPS_SMMU_CB10_TTBCR2_APPS_ADDR A:0x61e1a010
y.create.l HWIO_TCU_APPS_SMMU_CB11_TTBCR2_APPS_ADDR A:0x61e1b010
y.create.l HWIO_TCU_APPS_SMMU_CB12_TTBCR2_APPS_ADDR A:0x61e1c010
y.create.l HWIO_TCU_APPS_SMMU_CB13_TTBCR2_APPS_ADDR A:0x61e1d010
y.create.l HWIO_TCU_APPS_SMMU_CB14_TTBCR2_APPS_ADDR A:0x61e1e010
y.create.l HWIO_TCU_APPS_SMMU_CB15_TTBCR2_APPS_ADDR A:0x61e1f010
y.create.l HWIO_TCU_APPS_SMMU_CB0_TTBR0_LOW_APPS_ADDR A:0x61e10020
y.create.l HWIO_TCU_APPS_SMMU_CB1_TTBR0_LOW_APPS_ADDR A:0x61e11020
y.create.l HWIO_TCU_APPS_SMMU_CB2_TTBR0_LOW_APPS_ADDR A:0x61e12020
y.create.l HWIO_TCU_APPS_SMMU_CB3_TTBR0_LOW_APPS_ADDR A:0x61e13020
y.create.l HWIO_TCU_APPS_SMMU_CB4_TTBR0_LOW_APPS_ADDR A:0x61e14020
y.create.l HWIO_TCU_APPS_SMMU_CB5_TTBR0_LOW_APPS_ADDR A:0x61e15020
y.create.l HWIO_TCU_APPS_SMMU_CB6_TTBR0_LOW_APPS_ADDR A:0x61e16020
y.create.l HWIO_TCU_APPS_SMMU_CB7_TTBR0_LOW_APPS_ADDR A:0x61e17020
y.create.l HWIO_TCU_APPS_SMMU_CB8_TTBR0_LOW_APPS_ADDR A:0x61e18020
y.create.l HWIO_TCU_APPS_SMMU_CB9_TTBR0_LOW_APPS_ADDR A:0x61e19020
y.create.l HWIO_TCU_APPS_SMMU_CB10_TTBR0_LOW_APPS_ADDR A:0x61e1a020
y.create.l HWIO_TCU_APPS_SMMU_CB11_TTBR0_LOW_APPS_ADDR A:0x61e1b020
y.create.l HWIO_TCU_APPS_SMMU_CB12_TTBR0_LOW_APPS_ADDR A:0x61e1c020
y.create.l HWIO_TCU_APPS_SMMU_CB13_TTBR0_LOW_APPS_ADDR A:0x61e1d020
y.create.l HWIO_TCU_APPS_SMMU_CB14_TTBR0_LOW_APPS_ADDR A:0x61e1e020
y.create.l HWIO_TCU_APPS_SMMU_CB15_TTBR0_LOW_APPS_ADDR A:0x61e1f020
y.create.l HWIO_TCU_APPS_SMMU_CB0_TTBR0_HIGH_APPS_ADDR A:0x61e10024
y.create.l HWIO_TCU_APPS_SMMU_CB1_TTBR0_HIGH_APPS_ADDR A:0x61e11024
y.create.l HWIO_TCU_APPS_SMMU_CB2_TTBR0_HIGH_APPS_ADDR A:0x61e12024
y.create.l HWIO_TCU_APPS_SMMU_CB3_TTBR0_HIGH_APPS_ADDR A:0x61e13024
y.create.l HWIO_TCU_APPS_SMMU_CB4_TTBR0_HIGH_APPS_ADDR A:0x61e14024
y.create.l HWIO_TCU_APPS_SMMU_CB5_TTBR0_HIGH_APPS_ADDR A:0x61e15024
y.create.l HWIO_TCU_APPS_SMMU_CB6_TTBR0_HIGH_APPS_ADDR A:0x61e16024
y.create.l HWIO_TCU_APPS_SMMU_CB7_TTBR0_HIGH_APPS_ADDR A:0x61e17024
y.create.l HWIO_TCU_APPS_SMMU_CB8_TTBR0_HIGH_APPS_ADDR A:0x61e18024
y.create.l HWIO_TCU_APPS_SMMU_CB9_TTBR0_HIGH_APPS_ADDR A:0x61e19024
y.create.l HWIO_TCU_APPS_SMMU_CB10_TTBR0_HIGH_APPS_ADDR A:0x61e1a024
y.create.l HWIO_TCU_APPS_SMMU_CB11_TTBR0_HIGH_APPS_ADDR A:0x61e1b024
y.create.l HWIO_TCU_APPS_SMMU_CB12_TTBR0_HIGH_APPS_ADDR A:0x61e1c024
y.create.l HWIO_TCU_APPS_SMMU_CB13_TTBR0_HIGH_APPS_ADDR A:0x61e1d024
y.create.l HWIO_TCU_APPS_SMMU_CB14_TTBR0_HIGH_APPS_ADDR A:0x61e1e024
y.create.l HWIO_TCU_APPS_SMMU_CB15_TTBR0_HIGH_APPS_ADDR A:0x61e1f024
y.create.l HWIO_TCU_APPS_SMMU_CB0_TTBR1_LOW_APPS_ADDR A:0x61e10028
y.create.l HWIO_TCU_APPS_SMMU_CB1_TTBR1_LOW_APPS_ADDR A:0x61e11028
y.create.l HWIO_TCU_APPS_SMMU_CB2_TTBR1_LOW_APPS_ADDR A:0x61e12028
y.create.l HWIO_TCU_APPS_SMMU_CB3_TTBR1_LOW_APPS_ADDR A:0x61e13028
y.create.l HWIO_TCU_APPS_SMMU_CB4_TTBR1_LOW_APPS_ADDR A:0x61e14028
y.create.l HWIO_TCU_APPS_SMMU_CB5_TTBR1_LOW_APPS_ADDR A:0x61e15028
y.create.l HWIO_TCU_APPS_SMMU_CB6_TTBR1_LOW_APPS_ADDR A:0x61e16028
y.create.l HWIO_TCU_APPS_SMMU_CB7_TTBR1_LOW_APPS_ADDR A:0x61e17028
y.create.l HWIO_TCU_APPS_SMMU_CB8_TTBR1_LOW_APPS_ADDR A:0x61e18028
y.create.l HWIO_TCU_APPS_SMMU_CB9_TTBR1_LOW_APPS_ADDR A:0x61e19028
y.create.l HWIO_TCU_APPS_SMMU_CB10_TTBR1_LOW_APPS_ADDR A:0x61e1a028
y.create.l HWIO_TCU_APPS_SMMU_CB11_TTBR1_LOW_APPS_ADDR A:0x61e1b028
y.create.l HWIO_TCU_APPS_SMMU_CB12_TTBR1_LOW_APPS_ADDR A:0x61e1c028
y.create.l HWIO_TCU_APPS_SMMU_CB13_TTBR1_LOW_APPS_ADDR A:0x61e1d028
y.create.l HWIO_TCU_APPS_SMMU_CB14_TTBR1_LOW_APPS_ADDR A:0x61e1e028
y.create.l HWIO_TCU_APPS_SMMU_CB15_TTBR1_LOW_APPS_ADDR A:0x61e1f028
y.create.l HWIO_TCU_APPS_SMMU_CB0_TTBR1_HIGH_APPS_ADDR A:0x61e1002c
y.create.l HWIO_TCU_APPS_SMMU_CB1_TTBR1_HIGH_APPS_ADDR A:0x61e1102c
y.create.l HWIO_TCU_APPS_SMMU_CB2_TTBR1_HIGH_APPS_ADDR A:0x61e1202c
y.create.l HWIO_TCU_APPS_SMMU_CB3_TTBR1_HIGH_APPS_ADDR A:0x61e1302c
y.create.l HWIO_TCU_APPS_SMMU_CB4_TTBR1_HIGH_APPS_ADDR A:0x61e1402c
y.create.l HWIO_TCU_APPS_SMMU_CB5_TTBR1_HIGH_APPS_ADDR A:0x61e1502c
y.create.l HWIO_TCU_APPS_SMMU_CB6_TTBR1_HIGH_APPS_ADDR A:0x61e1602c
y.create.l HWIO_TCU_APPS_SMMU_CB7_TTBR1_HIGH_APPS_ADDR A:0x61e1702c
y.create.l HWIO_TCU_APPS_SMMU_CB8_TTBR1_HIGH_APPS_ADDR A:0x61e1802c
y.create.l HWIO_TCU_APPS_SMMU_CB9_TTBR1_HIGH_APPS_ADDR A:0x61e1902c
y.create.l HWIO_TCU_APPS_SMMU_CB10_TTBR1_HIGH_APPS_ADDR A:0x61e1a02c
y.create.l HWIO_TCU_APPS_SMMU_CB11_TTBR1_HIGH_APPS_ADDR A:0x61e1b02c
y.create.l HWIO_TCU_APPS_SMMU_CB12_TTBR1_HIGH_APPS_ADDR A:0x61e1c02c
y.create.l HWIO_TCU_APPS_SMMU_CB13_TTBR1_HIGH_APPS_ADDR A:0x61e1d02c
y.create.l HWIO_TCU_APPS_SMMU_CB14_TTBR1_HIGH_APPS_ADDR A:0x61e1e02c
y.create.l HWIO_TCU_APPS_SMMU_CB15_TTBR1_HIGH_APPS_ADDR A:0x61e1f02c
y.create.l HWIO_TCU_APPS_SMMU_CB0_TTBCR_LPAE_APPS_ADDR A:0x61e10030
y.create.l HWIO_TCU_APPS_SMMU_CB1_TTBCR_LPAE_APPS_ADDR A:0x61e11030
y.create.l HWIO_TCU_APPS_SMMU_CB2_TTBCR_LPAE_APPS_ADDR A:0x61e12030
y.create.l HWIO_TCU_APPS_SMMU_CB3_TTBCR_LPAE_APPS_ADDR A:0x61e13030
y.create.l HWIO_TCU_APPS_SMMU_CB4_TTBCR_LPAE_APPS_ADDR A:0x61e14030
y.create.l HWIO_TCU_APPS_SMMU_CB5_TTBCR_LPAE_APPS_ADDR A:0x61e15030
y.create.l HWIO_TCU_APPS_SMMU_CB6_TTBCR_LPAE_APPS_ADDR A:0x61e16030
y.create.l HWIO_TCU_APPS_SMMU_CB7_TTBCR_LPAE_APPS_ADDR A:0x61e17030
y.create.l HWIO_TCU_APPS_SMMU_CB8_TTBCR_LPAE_APPS_ADDR A:0x61e18030
y.create.l HWIO_TCU_APPS_SMMU_CB9_TTBCR_LPAE_APPS_ADDR A:0x61e19030
y.create.l HWIO_TCU_APPS_SMMU_CB10_TTBCR_LPAE_APPS_ADDR A:0x61e1a030
y.create.l HWIO_TCU_APPS_SMMU_CB11_TTBCR_LPAE_APPS_ADDR A:0x61e1b030
y.create.l HWIO_TCU_APPS_SMMU_CB12_TTBCR_LPAE_APPS_ADDR A:0x61e1c030
y.create.l HWIO_TCU_APPS_SMMU_CB13_TTBCR_LPAE_APPS_ADDR A:0x61e1d030
y.create.l HWIO_TCU_APPS_SMMU_CB14_TTBCR_LPAE_APPS_ADDR A:0x61e1e030
y.create.l HWIO_TCU_APPS_SMMU_CB15_TTBCR_LPAE_APPS_ADDR A:0x61e1f030
y.create.l HWIO_TCU_APPS_SMMU_CB0_CONTEXTIDR_APPS_ADDR A:0x61e10034
y.create.l HWIO_TCU_APPS_SMMU_CB1_CONTEXTIDR_APPS_ADDR A:0x61e11034
y.create.l HWIO_TCU_APPS_SMMU_CB2_CONTEXTIDR_APPS_ADDR A:0x61e12034
y.create.l HWIO_TCU_APPS_SMMU_CB3_CONTEXTIDR_APPS_ADDR A:0x61e13034
y.create.l HWIO_TCU_APPS_SMMU_CB4_CONTEXTIDR_APPS_ADDR A:0x61e14034
y.create.l HWIO_TCU_APPS_SMMU_CB5_CONTEXTIDR_APPS_ADDR A:0x61e15034
y.create.l HWIO_TCU_APPS_SMMU_CB6_CONTEXTIDR_APPS_ADDR A:0x61e16034
y.create.l HWIO_TCU_APPS_SMMU_CB7_CONTEXTIDR_APPS_ADDR A:0x61e17034
y.create.l HWIO_TCU_APPS_SMMU_CB8_CONTEXTIDR_APPS_ADDR A:0x61e18034
y.create.l HWIO_TCU_APPS_SMMU_CB9_CONTEXTIDR_APPS_ADDR A:0x61e19034
y.create.l HWIO_TCU_APPS_SMMU_CB10_CONTEXTIDR_APPS_ADDR A:0x61e1a034
y.create.l HWIO_TCU_APPS_SMMU_CB11_CONTEXTIDR_APPS_ADDR A:0x61e1b034
y.create.l HWIO_TCU_APPS_SMMU_CB12_CONTEXTIDR_APPS_ADDR A:0x61e1c034
y.create.l HWIO_TCU_APPS_SMMU_CB13_CONTEXTIDR_APPS_ADDR A:0x61e1d034
y.create.l HWIO_TCU_APPS_SMMU_CB14_CONTEXTIDR_APPS_ADDR A:0x61e1e034
y.create.l HWIO_TCU_APPS_SMMU_CB15_CONTEXTIDR_APPS_ADDR A:0x61e1f034
y.create.l HWIO_TCU_APPS_SMMU_CB0_PRRR_MAIR0_APPS_ADDR A:0x61e10038
y.create.l HWIO_TCU_APPS_SMMU_CB1_PRRR_MAIR0_APPS_ADDR A:0x61e11038
y.create.l HWIO_TCU_APPS_SMMU_CB2_PRRR_MAIR0_APPS_ADDR A:0x61e12038
y.create.l HWIO_TCU_APPS_SMMU_CB3_PRRR_MAIR0_APPS_ADDR A:0x61e13038
y.create.l HWIO_TCU_APPS_SMMU_CB4_PRRR_MAIR0_APPS_ADDR A:0x61e14038
y.create.l HWIO_TCU_APPS_SMMU_CB5_PRRR_MAIR0_APPS_ADDR A:0x61e15038
y.create.l HWIO_TCU_APPS_SMMU_CB6_PRRR_MAIR0_APPS_ADDR A:0x61e16038
y.create.l HWIO_TCU_APPS_SMMU_CB7_PRRR_MAIR0_APPS_ADDR A:0x61e17038
y.create.l HWIO_TCU_APPS_SMMU_CB8_PRRR_MAIR0_APPS_ADDR A:0x61e18038
y.create.l HWIO_TCU_APPS_SMMU_CB9_PRRR_MAIR0_APPS_ADDR A:0x61e19038
y.create.l HWIO_TCU_APPS_SMMU_CB10_PRRR_MAIR0_APPS_ADDR A:0x61e1a038
y.create.l HWIO_TCU_APPS_SMMU_CB11_PRRR_MAIR0_APPS_ADDR A:0x61e1b038
y.create.l HWIO_TCU_APPS_SMMU_CB12_PRRR_MAIR0_APPS_ADDR A:0x61e1c038
y.create.l HWIO_TCU_APPS_SMMU_CB13_PRRR_MAIR0_APPS_ADDR A:0x61e1d038
y.create.l HWIO_TCU_APPS_SMMU_CB14_PRRR_MAIR0_APPS_ADDR A:0x61e1e038
y.create.l HWIO_TCU_APPS_SMMU_CB15_PRRR_MAIR0_APPS_ADDR A:0x61e1f038
y.create.l HWIO_TCU_APPS_SMMU_CB0_NMRR_MAIR1_APPS_ADDR A:0x61e1003c
y.create.l HWIO_TCU_APPS_SMMU_CB1_NMRR_MAIR1_APPS_ADDR A:0x61e1103c
y.create.l HWIO_TCU_APPS_SMMU_CB2_NMRR_MAIR1_APPS_ADDR A:0x61e1203c
y.create.l HWIO_TCU_APPS_SMMU_CB3_NMRR_MAIR1_APPS_ADDR A:0x61e1303c
y.create.l HWIO_TCU_APPS_SMMU_CB4_NMRR_MAIR1_APPS_ADDR A:0x61e1403c
y.create.l HWIO_TCU_APPS_SMMU_CB5_NMRR_MAIR1_APPS_ADDR A:0x61e1503c
y.create.l HWIO_TCU_APPS_SMMU_CB6_NMRR_MAIR1_APPS_ADDR A:0x61e1603c
y.create.l HWIO_TCU_APPS_SMMU_CB7_NMRR_MAIR1_APPS_ADDR A:0x61e1703c
y.create.l HWIO_TCU_APPS_SMMU_CB8_NMRR_MAIR1_APPS_ADDR A:0x61e1803c
y.create.l HWIO_TCU_APPS_SMMU_CB9_NMRR_MAIR1_APPS_ADDR A:0x61e1903c
y.create.l HWIO_TCU_APPS_SMMU_CB10_NMRR_MAIR1_APPS_ADDR A:0x61e1a03c
y.create.l HWIO_TCU_APPS_SMMU_CB11_NMRR_MAIR1_APPS_ADDR A:0x61e1b03c
y.create.l HWIO_TCU_APPS_SMMU_CB12_NMRR_MAIR1_APPS_ADDR A:0x61e1c03c
y.create.l HWIO_TCU_APPS_SMMU_CB13_NMRR_MAIR1_APPS_ADDR A:0x61e1d03c
y.create.l HWIO_TCU_APPS_SMMU_CB14_NMRR_MAIR1_APPS_ADDR A:0x61e1e03c
y.create.l HWIO_TCU_APPS_SMMU_CB15_NMRR_MAIR1_APPS_ADDR A:0x61e1f03c
y.create.l HWIO_TCU_APPS_SMMU_CB0_FSR_APPS_ADDR A:0x61e10058
y.create.l HWIO_TCU_APPS_SMMU_CB1_FSR_APPS_ADDR A:0x61e11058
y.create.l HWIO_TCU_APPS_SMMU_CB2_FSR_APPS_ADDR A:0x61e12058
y.create.l HWIO_TCU_APPS_SMMU_CB3_FSR_APPS_ADDR A:0x61e13058
y.create.l HWIO_TCU_APPS_SMMU_CB4_FSR_APPS_ADDR A:0x61e14058
y.create.l HWIO_TCU_APPS_SMMU_CB5_FSR_APPS_ADDR A:0x61e15058
y.create.l HWIO_TCU_APPS_SMMU_CB6_FSR_APPS_ADDR A:0x61e16058
y.create.l HWIO_TCU_APPS_SMMU_CB7_FSR_APPS_ADDR A:0x61e17058
y.create.l HWIO_TCU_APPS_SMMU_CB8_FSR_APPS_ADDR A:0x61e18058
y.create.l HWIO_TCU_APPS_SMMU_CB9_FSR_APPS_ADDR A:0x61e19058
y.create.l HWIO_TCU_APPS_SMMU_CB10_FSR_APPS_ADDR A:0x61e1a058
y.create.l HWIO_TCU_APPS_SMMU_CB11_FSR_APPS_ADDR A:0x61e1b058
y.create.l HWIO_TCU_APPS_SMMU_CB12_FSR_APPS_ADDR A:0x61e1c058
y.create.l HWIO_TCU_APPS_SMMU_CB13_FSR_APPS_ADDR A:0x61e1d058
y.create.l HWIO_TCU_APPS_SMMU_CB14_FSR_APPS_ADDR A:0x61e1e058
y.create.l HWIO_TCU_APPS_SMMU_CB15_FSR_APPS_ADDR A:0x61e1f058
y.create.l HWIO_TCU_APPS_SMMU_CB0_FSRRESTORE_APPS_ADDR A:0x61e1005c
y.create.l HWIO_TCU_APPS_SMMU_CB1_FSRRESTORE_APPS_ADDR A:0x61e1105c
y.create.l HWIO_TCU_APPS_SMMU_CB2_FSRRESTORE_APPS_ADDR A:0x61e1205c
y.create.l HWIO_TCU_APPS_SMMU_CB3_FSRRESTORE_APPS_ADDR A:0x61e1305c
y.create.l HWIO_TCU_APPS_SMMU_CB4_FSRRESTORE_APPS_ADDR A:0x61e1405c
y.create.l HWIO_TCU_APPS_SMMU_CB5_FSRRESTORE_APPS_ADDR A:0x61e1505c
y.create.l HWIO_TCU_APPS_SMMU_CB6_FSRRESTORE_APPS_ADDR A:0x61e1605c
y.create.l HWIO_TCU_APPS_SMMU_CB7_FSRRESTORE_APPS_ADDR A:0x61e1705c
y.create.l HWIO_TCU_APPS_SMMU_CB8_FSRRESTORE_APPS_ADDR A:0x61e1805c
y.create.l HWIO_TCU_APPS_SMMU_CB9_FSRRESTORE_APPS_ADDR A:0x61e1905c
y.create.l HWIO_TCU_APPS_SMMU_CB10_FSRRESTORE_APPS_ADDR A:0x61e1a05c
y.create.l HWIO_TCU_APPS_SMMU_CB11_FSRRESTORE_APPS_ADDR A:0x61e1b05c
y.create.l HWIO_TCU_APPS_SMMU_CB12_FSRRESTORE_APPS_ADDR A:0x61e1c05c
y.create.l HWIO_TCU_APPS_SMMU_CB13_FSRRESTORE_APPS_ADDR A:0x61e1d05c
y.create.l HWIO_TCU_APPS_SMMU_CB14_FSRRESTORE_APPS_ADDR A:0x61e1e05c
y.create.l HWIO_TCU_APPS_SMMU_CB15_FSRRESTORE_APPS_ADDR A:0x61e1f05c
y.create.l HWIO_TCU_APPS_SMMU_CB0_FAR_LOW_APPS_ADDR A:0x61e10060
y.create.l HWIO_TCU_APPS_SMMU_CB1_FAR_LOW_APPS_ADDR A:0x61e11060
y.create.l HWIO_TCU_APPS_SMMU_CB2_FAR_LOW_APPS_ADDR A:0x61e12060
y.create.l HWIO_TCU_APPS_SMMU_CB3_FAR_LOW_APPS_ADDR A:0x61e13060
y.create.l HWIO_TCU_APPS_SMMU_CB4_FAR_LOW_APPS_ADDR A:0x61e14060
y.create.l HWIO_TCU_APPS_SMMU_CB5_FAR_LOW_APPS_ADDR A:0x61e15060
y.create.l HWIO_TCU_APPS_SMMU_CB6_FAR_LOW_APPS_ADDR A:0x61e16060
y.create.l HWIO_TCU_APPS_SMMU_CB7_FAR_LOW_APPS_ADDR A:0x61e17060
y.create.l HWIO_TCU_APPS_SMMU_CB8_FAR_LOW_APPS_ADDR A:0x61e18060
y.create.l HWIO_TCU_APPS_SMMU_CB9_FAR_LOW_APPS_ADDR A:0x61e19060
y.create.l HWIO_TCU_APPS_SMMU_CB10_FAR_LOW_APPS_ADDR A:0x61e1a060
y.create.l HWIO_TCU_APPS_SMMU_CB11_FAR_LOW_APPS_ADDR A:0x61e1b060
y.create.l HWIO_TCU_APPS_SMMU_CB12_FAR_LOW_APPS_ADDR A:0x61e1c060
y.create.l HWIO_TCU_APPS_SMMU_CB13_FAR_LOW_APPS_ADDR A:0x61e1d060
y.create.l HWIO_TCU_APPS_SMMU_CB14_FAR_LOW_APPS_ADDR A:0x61e1e060
y.create.l HWIO_TCU_APPS_SMMU_CB15_FAR_LOW_APPS_ADDR A:0x61e1f060
y.create.l HWIO_TCU_APPS_SMMU_CB0_FAR_HIGH_APPS_ADDR A:0x61e10064
y.create.l HWIO_TCU_APPS_SMMU_CB1_FAR_HIGH_APPS_ADDR A:0x61e11064
y.create.l HWIO_TCU_APPS_SMMU_CB2_FAR_HIGH_APPS_ADDR A:0x61e12064
y.create.l HWIO_TCU_APPS_SMMU_CB3_FAR_HIGH_APPS_ADDR A:0x61e13064
y.create.l HWIO_TCU_APPS_SMMU_CB4_FAR_HIGH_APPS_ADDR A:0x61e14064
y.create.l HWIO_TCU_APPS_SMMU_CB5_FAR_HIGH_APPS_ADDR A:0x61e15064
y.create.l HWIO_TCU_APPS_SMMU_CB6_FAR_HIGH_APPS_ADDR A:0x61e16064
y.create.l HWIO_TCU_APPS_SMMU_CB7_FAR_HIGH_APPS_ADDR A:0x61e17064
y.create.l HWIO_TCU_APPS_SMMU_CB8_FAR_HIGH_APPS_ADDR A:0x61e18064
y.create.l HWIO_TCU_APPS_SMMU_CB9_FAR_HIGH_APPS_ADDR A:0x61e19064
y.create.l HWIO_TCU_APPS_SMMU_CB10_FAR_HIGH_APPS_ADDR A:0x61e1a064
y.create.l HWIO_TCU_APPS_SMMU_CB11_FAR_HIGH_APPS_ADDR A:0x61e1b064
y.create.l HWIO_TCU_APPS_SMMU_CB12_FAR_HIGH_APPS_ADDR A:0x61e1c064
y.create.l HWIO_TCU_APPS_SMMU_CB13_FAR_HIGH_APPS_ADDR A:0x61e1d064
y.create.l HWIO_TCU_APPS_SMMU_CB14_FAR_HIGH_APPS_ADDR A:0x61e1e064
y.create.l HWIO_TCU_APPS_SMMU_CB15_FAR_HIGH_APPS_ADDR A:0x61e1f064
y.create.l HWIO_TCU_APPS_SMMU_CB0_FSYNR0_APPS_ADDR A:0x61e10068
y.create.l HWIO_TCU_APPS_SMMU_CB1_FSYNR0_APPS_ADDR A:0x61e11068
y.create.l HWIO_TCU_APPS_SMMU_CB2_FSYNR0_APPS_ADDR A:0x61e12068
y.create.l HWIO_TCU_APPS_SMMU_CB3_FSYNR0_APPS_ADDR A:0x61e13068
y.create.l HWIO_TCU_APPS_SMMU_CB4_FSYNR0_APPS_ADDR A:0x61e14068
y.create.l HWIO_TCU_APPS_SMMU_CB5_FSYNR0_APPS_ADDR A:0x61e15068
y.create.l HWIO_TCU_APPS_SMMU_CB6_FSYNR0_APPS_ADDR A:0x61e16068
y.create.l HWIO_TCU_APPS_SMMU_CB7_FSYNR0_APPS_ADDR A:0x61e17068
y.create.l HWIO_TCU_APPS_SMMU_CB8_FSYNR0_APPS_ADDR A:0x61e18068
y.create.l HWIO_TCU_APPS_SMMU_CB9_FSYNR0_APPS_ADDR A:0x61e19068
y.create.l HWIO_TCU_APPS_SMMU_CB10_FSYNR0_APPS_ADDR A:0x61e1a068
y.create.l HWIO_TCU_APPS_SMMU_CB11_FSYNR0_APPS_ADDR A:0x61e1b068
y.create.l HWIO_TCU_APPS_SMMU_CB12_FSYNR0_APPS_ADDR A:0x61e1c068
y.create.l HWIO_TCU_APPS_SMMU_CB13_FSYNR0_APPS_ADDR A:0x61e1d068
y.create.l HWIO_TCU_APPS_SMMU_CB14_FSYNR0_APPS_ADDR A:0x61e1e068
y.create.l HWIO_TCU_APPS_SMMU_CB15_FSYNR0_APPS_ADDR A:0x61e1f068
y.create.l HWIO_TCU_APPS_SMMU_CB0_IPAFAR_LOW_APPS_ADDR A:0x61e10070
y.create.l HWIO_TCU_APPS_SMMU_CB1_IPAFAR_LOW_APPS_ADDR A:0x61e11070
y.create.l HWIO_TCU_APPS_SMMU_CB2_IPAFAR_LOW_APPS_ADDR A:0x61e12070
y.create.l HWIO_TCU_APPS_SMMU_CB3_IPAFAR_LOW_APPS_ADDR A:0x61e13070
y.create.l HWIO_TCU_APPS_SMMU_CB4_IPAFAR_LOW_APPS_ADDR A:0x61e14070
y.create.l HWIO_TCU_APPS_SMMU_CB5_IPAFAR_LOW_APPS_ADDR A:0x61e15070
y.create.l HWIO_TCU_APPS_SMMU_CB6_IPAFAR_LOW_APPS_ADDR A:0x61e16070
y.create.l HWIO_TCU_APPS_SMMU_CB7_IPAFAR_LOW_APPS_ADDR A:0x61e17070
y.create.l HWIO_TCU_APPS_SMMU_CB8_IPAFAR_LOW_APPS_ADDR A:0x61e18070
y.create.l HWIO_TCU_APPS_SMMU_CB9_IPAFAR_LOW_APPS_ADDR A:0x61e19070
y.create.l HWIO_TCU_APPS_SMMU_CB10_IPAFAR_LOW_APPS_ADDR A:0x61e1a070
y.create.l HWIO_TCU_APPS_SMMU_CB11_IPAFAR_LOW_APPS_ADDR A:0x61e1b070
y.create.l HWIO_TCU_APPS_SMMU_CB12_IPAFAR_LOW_APPS_ADDR A:0x61e1c070
y.create.l HWIO_TCU_APPS_SMMU_CB13_IPAFAR_LOW_APPS_ADDR A:0x61e1d070
y.create.l HWIO_TCU_APPS_SMMU_CB14_IPAFAR_LOW_APPS_ADDR A:0x61e1e070
y.create.l HWIO_TCU_APPS_SMMU_CB15_IPAFAR_LOW_APPS_ADDR A:0x61e1f070
y.create.l HWIO_TCU_APPS_SMMU_CB0_IPAFAR_HIGH_APPS_ADDR A:0x61e10074
y.create.l HWIO_TCU_APPS_SMMU_CB1_IPAFAR_HIGH_APPS_ADDR A:0x61e11074
y.create.l HWIO_TCU_APPS_SMMU_CB2_IPAFAR_HIGH_APPS_ADDR A:0x61e12074
y.create.l HWIO_TCU_APPS_SMMU_CB3_IPAFAR_HIGH_APPS_ADDR A:0x61e13074
y.create.l HWIO_TCU_APPS_SMMU_CB4_IPAFAR_HIGH_APPS_ADDR A:0x61e14074
y.create.l HWIO_TCU_APPS_SMMU_CB5_IPAFAR_HIGH_APPS_ADDR A:0x61e15074
y.create.l HWIO_TCU_APPS_SMMU_CB6_IPAFAR_HIGH_APPS_ADDR A:0x61e16074
y.create.l HWIO_TCU_APPS_SMMU_CB7_IPAFAR_HIGH_APPS_ADDR A:0x61e17074
y.create.l HWIO_TCU_APPS_SMMU_CB8_IPAFAR_HIGH_APPS_ADDR A:0x61e18074
y.create.l HWIO_TCU_APPS_SMMU_CB9_IPAFAR_HIGH_APPS_ADDR A:0x61e19074
y.create.l HWIO_TCU_APPS_SMMU_CB10_IPAFAR_HIGH_APPS_ADDR A:0x61e1a074
y.create.l HWIO_TCU_APPS_SMMU_CB11_IPAFAR_HIGH_APPS_ADDR A:0x61e1b074
y.create.l HWIO_TCU_APPS_SMMU_CB12_IPAFAR_HIGH_APPS_ADDR A:0x61e1c074
y.create.l HWIO_TCU_APPS_SMMU_CB13_IPAFAR_HIGH_APPS_ADDR A:0x61e1d074
y.create.l HWIO_TCU_APPS_SMMU_CB14_IPAFAR_HIGH_APPS_ADDR A:0x61e1e074
y.create.l HWIO_TCU_APPS_SMMU_CB15_IPAFAR_HIGH_APPS_ADDR A:0x61e1f074
y.create.l HWIO_TCU_APPS_SMMU_CB0_TLBIVA_LOW_APPS_ADDR A:0x61e10600
y.create.l HWIO_TCU_APPS_SMMU_CB1_TLBIVA_LOW_APPS_ADDR A:0x61e11600
y.create.l HWIO_TCU_APPS_SMMU_CB2_TLBIVA_LOW_APPS_ADDR A:0x61e12600
y.create.l HWIO_TCU_APPS_SMMU_CB3_TLBIVA_LOW_APPS_ADDR A:0x61e13600
y.create.l HWIO_TCU_APPS_SMMU_CB4_TLBIVA_LOW_APPS_ADDR A:0x61e14600
y.create.l HWIO_TCU_APPS_SMMU_CB5_TLBIVA_LOW_APPS_ADDR A:0x61e15600
y.create.l HWIO_TCU_APPS_SMMU_CB6_TLBIVA_LOW_APPS_ADDR A:0x61e16600
y.create.l HWIO_TCU_APPS_SMMU_CB7_TLBIVA_LOW_APPS_ADDR A:0x61e17600
y.create.l HWIO_TCU_APPS_SMMU_CB8_TLBIVA_LOW_APPS_ADDR A:0x61e18600
y.create.l HWIO_TCU_APPS_SMMU_CB9_TLBIVA_LOW_APPS_ADDR A:0x61e19600
y.create.l HWIO_TCU_APPS_SMMU_CB10_TLBIVA_LOW_APPS_ADDR A:0x61e1a600
y.create.l HWIO_TCU_APPS_SMMU_CB11_TLBIVA_LOW_APPS_ADDR A:0x61e1b600
y.create.l HWIO_TCU_APPS_SMMU_CB12_TLBIVA_LOW_APPS_ADDR A:0x61e1c600
y.create.l HWIO_TCU_APPS_SMMU_CB13_TLBIVA_LOW_APPS_ADDR A:0x61e1d600
y.create.l HWIO_TCU_APPS_SMMU_CB14_TLBIVA_LOW_APPS_ADDR A:0x61e1e600
y.create.l HWIO_TCU_APPS_SMMU_CB15_TLBIVA_LOW_APPS_ADDR A:0x61e1f600
y.create.l HWIO_TCU_APPS_SMMU_CB0_TLBIVA_HIGH_APPS_ADDR A:0x61e10604
y.create.l HWIO_TCU_APPS_SMMU_CB1_TLBIVA_HIGH_APPS_ADDR A:0x61e11604
y.create.l HWIO_TCU_APPS_SMMU_CB2_TLBIVA_HIGH_APPS_ADDR A:0x61e12604
y.create.l HWIO_TCU_APPS_SMMU_CB3_TLBIVA_HIGH_APPS_ADDR A:0x61e13604
y.create.l HWIO_TCU_APPS_SMMU_CB4_TLBIVA_HIGH_APPS_ADDR A:0x61e14604
y.create.l HWIO_TCU_APPS_SMMU_CB5_TLBIVA_HIGH_APPS_ADDR A:0x61e15604
y.create.l HWIO_TCU_APPS_SMMU_CB6_TLBIVA_HIGH_APPS_ADDR A:0x61e16604
y.create.l HWIO_TCU_APPS_SMMU_CB7_TLBIVA_HIGH_APPS_ADDR A:0x61e17604
y.create.l HWIO_TCU_APPS_SMMU_CB8_TLBIVA_HIGH_APPS_ADDR A:0x61e18604
y.create.l HWIO_TCU_APPS_SMMU_CB9_TLBIVA_HIGH_APPS_ADDR A:0x61e19604
y.create.l HWIO_TCU_APPS_SMMU_CB10_TLBIVA_HIGH_APPS_ADDR A:0x61e1a604
y.create.l HWIO_TCU_APPS_SMMU_CB11_TLBIVA_HIGH_APPS_ADDR A:0x61e1b604
y.create.l HWIO_TCU_APPS_SMMU_CB12_TLBIVA_HIGH_APPS_ADDR A:0x61e1c604
y.create.l HWIO_TCU_APPS_SMMU_CB13_TLBIVA_HIGH_APPS_ADDR A:0x61e1d604
y.create.l HWIO_TCU_APPS_SMMU_CB14_TLBIVA_HIGH_APPS_ADDR A:0x61e1e604
y.create.l HWIO_TCU_APPS_SMMU_CB15_TLBIVA_HIGH_APPS_ADDR A:0x61e1f604
y.create.l HWIO_TCU_APPS_SMMU_CB0_TLBIVAA_LOW_APPS_ADDR A:0x61e10608
y.create.l HWIO_TCU_APPS_SMMU_CB1_TLBIVAA_LOW_APPS_ADDR A:0x61e11608
y.create.l HWIO_TCU_APPS_SMMU_CB2_TLBIVAA_LOW_APPS_ADDR A:0x61e12608
y.create.l HWIO_TCU_APPS_SMMU_CB3_TLBIVAA_LOW_APPS_ADDR A:0x61e13608
y.create.l HWIO_TCU_APPS_SMMU_CB4_TLBIVAA_LOW_APPS_ADDR A:0x61e14608
y.create.l HWIO_TCU_APPS_SMMU_CB5_TLBIVAA_LOW_APPS_ADDR A:0x61e15608
y.create.l HWIO_TCU_APPS_SMMU_CB6_TLBIVAA_LOW_APPS_ADDR A:0x61e16608
y.create.l HWIO_TCU_APPS_SMMU_CB7_TLBIVAA_LOW_APPS_ADDR A:0x61e17608
y.create.l HWIO_TCU_APPS_SMMU_CB8_TLBIVAA_LOW_APPS_ADDR A:0x61e18608
y.create.l HWIO_TCU_APPS_SMMU_CB9_TLBIVAA_LOW_APPS_ADDR A:0x61e19608
y.create.l HWIO_TCU_APPS_SMMU_CB10_TLBIVAA_LOW_APPS_ADDR A:0x61e1a608
y.create.l HWIO_TCU_APPS_SMMU_CB11_TLBIVAA_LOW_APPS_ADDR A:0x61e1b608
y.create.l HWIO_TCU_APPS_SMMU_CB12_TLBIVAA_LOW_APPS_ADDR A:0x61e1c608
y.create.l HWIO_TCU_APPS_SMMU_CB13_TLBIVAA_LOW_APPS_ADDR A:0x61e1d608
y.create.l HWIO_TCU_APPS_SMMU_CB14_TLBIVAA_LOW_APPS_ADDR A:0x61e1e608
y.create.l HWIO_TCU_APPS_SMMU_CB15_TLBIVAA_LOW_APPS_ADDR A:0x61e1f608
y.create.l HWIO_TCU_APPS_SMMU_CB0_TLBIVAA_HIGH_APPS_ADDR A:0x61e1060c
y.create.l HWIO_TCU_APPS_SMMU_CB1_TLBIVAA_HIGH_APPS_ADDR A:0x61e1160c
y.create.l HWIO_TCU_APPS_SMMU_CB2_TLBIVAA_HIGH_APPS_ADDR A:0x61e1260c
y.create.l HWIO_TCU_APPS_SMMU_CB3_TLBIVAA_HIGH_APPS_ADDR A:0x61e1360c
y.create.l HWIO_TCU_APPS_SMMU_CB4_TLBIVAA_HIGH_APPS_ADDR A:0x61e1460c
y.create.l HWIO_TCU_APPS_SMMU_CB5_TLBIVAA_HIGH_APPS_ADDR A:0x61e1560c
y.create.l HWIO_TCU_APPS_SMMU_CB6_TLBIVAA_HIGH_APPS_ADDR A:0x61e1660c
y.create.l HWIO_TCU_APPS_SMMU_CB7_TLBIVAA_HIGH_APPS_ADDR A:0x61e1760c
y.create.l HWIO_TCU_APPS_SMMU_CB8_TLBIVAA_HIGH_APPS_ADDR A:0x61e1860c
y.create.l HWIO_TCU_APPS_SMMU_CB9_TLBIVAA_HIGH_APPS_ADDR A:0x61e1960c
y.create.l HWIO_TCU_APPS_SMMU_CB10_TLBIVAA_HIGH_APPS_ADDR A:0x61e1a60c
y.create.l HWIO_TCU_APPS_SMMU_CB11_TLBIVAA_HIGH_APPS_ADDR A:0x61e1b60c
y.create.l HWIO_TCU_APPS_SMMU_CB12_TLBIVAA_HIGH_APPS_ADDR A:0x61e1c60c
y.create.l HWIO_TCU_APPS_SMMU_CB13_TLBIVAA_HIGH_APPS_ADDR A:0x61e1d60c
y.create.l HWIO_TCU_APPS_SMMU_CB14_TLBIVAA_HIGH_APPS_ADDR A:0x61e1e60c
y.create.l HWIO_TCU_APPS_SMMU_CB15_TLBIVAA_HIGH_APPS_ADDR A:0x61e1f60c
y.create.l HWIO_TCU_APPS_SMMU_CB0_TLBIASID_APPS_ADDR A:0x61e10610
y.create.l HWIO_TCU_APPS_SMMU_CB1_TLBIASID_APPS_ADDR A:0x61e11610
y.create.l HWIO_TCU_APPS_SMMU_CB2_TLBIASID_APPS_ADDR A:0x61e12610
y.create.l HWIO_TCU_APPS_SMMU_CB3_TLBIASID_APPS_ADDR A:0x61e13610
y.create.l HWIO_TCU_APPS_SMMU_CB4_TLBIASID_APPS_ADDR A:0x61e14610
y.create.l HWIO_TCU_APPS_SMMU_CB5_TLBIASID_APPS_ADDR A:0x61e15610
y.create.l HWIO_TCU_APPS_SMMU_CB6_TLBIASID_APPS_ADDR A:0x61e16610
y.create.l HWIO_TCU_APPS_SMMU_CB7_TLBIASID_APPS_ADDR A:0x61e17610
y.create.l HWIO_TCU_APPS_SMMU_CB8_TLBIASID_APPS_ADDR A:0x61e18610
y.create.l HWIO_TCU_APPS_SMMU_CB9_TLBIASID_APPS_ADDR A:0x61e19610
y.create.l HWIO_TCU_APPS_SMMU_CB10_TLBIASID_APPS_ADDR A:0x61e1a610
y.create.l HWIO_TCU_APPS_SMMU_CB11_TLBIASID_APPS_ADDR A:0x61e1b610
y.create.l HWIO_TCU_APPS_SMMU_CB12_TLBIASID_APPS_ADDR A:0x61e1c610
y.create.l HWIO_TCU_APPS_SMMU_CB13_TLBIASID_APPS_ADDR A:0x61e1d610
y.create.l HWIO_TCU_APPS_SMMU_CB14_TLBIASID_APPS_ADDR A:0x61e1e610
y.create.l HWIO_TCU_APPS_SMMU_CB15_TLBIASID_APPS_ADDR A:0x61e1f610
y.create.l HWIO_TCU_APPS_SMMU_CB0_TLBIALL_APPS_ADDR A:0x61e10618
y.create.l HWIO_TCU_APPS_SMMU_CB1_TLBIALL_APPS_ADDR A:0x61e11618
y.create.l HWIO_TCU_APPS_SMMU_CB2_TLBIALL_APPS_ADDR A:0x61e12618
y.create.l HWIO_TCU_APPS_SMMU_CB3_TLBIALL_APPS_ADDR A:0x61e13618
y.create.l HWIO_TCU_APPS_SMMU_CB4_TLBIALL_APPS_ADDR A:0x61e14618
y.create.l HWIO_TCU_APPS_SMMU_CB5_TLBIALL_APPS_ADDR A:0x61e15618
y.create.l HWIO_TCU_APPS_SMMU_CB6_TLBIALL_APPS_ADDR A:0x61e16618
y.create.l HWIO_TCU_APPS_SMMU_CB7_TLBIALL_APPS_ADDR A:0x61e17618
y.create.l HWIO_TCU_APPS_SMMU_CB8_TLBIALL_APPS_ADDR A:0x61e18618
y.create.l HWIO_TCU_APPS_SMMU_CB9_TLBIALL_APPS_ADDR A:0x61e19618
y.create.l HWIO_TCU_APPS_SMMU_CB10_TLBIALL_APPS_ADDR A:0x61e1a618
y.create.l HWIO_TCU_APPS_SMMU_CB11_TLBIALL_APPS_ADDR A:0x61e1b618
y.create.l HWIO_TCU_APPS_SMMU_CB12_TLBIALL_APPS_ADDR A:0x61e1c618
y.create.l HWIO_TCU_APPS_SMMU_CB13_TLBIALL_APPS_ADDR A:0x61e1d618
y.create.l HWIO_TCU_APPS_SMMU_CB14_TLBIALL_APPS_ADDR A:0x61e1e618
y.create.l HWIO_TCU_APPS_SMMU_CB15_TLBIALL_APPS_ADDR A:0x61e1f618
y.create.l HWIO_TCU_APPS_SMMU_CB0_TLBIVAL_LOW_APPS_ADDR A:0x61e10620
y.create.l HWIO_TCU_APPS_SMMU_CB1_TLBIVAL_LOW_APPS_ADDR A:0x61e11620
y.create.l HWIO_TCU_APPS_SMMU_CB2_TLBIVAL_LOW_APPS_ADDR A:0x61e12620
y.create.l HWIO_TCU_APPS_SMMU_CB3_TLBIVAL_LOW_APPS_ADDR A:0x61e13620
y.create.l HWIO_TCU_APPS_SMMU_CB4_TLBIVAL_LOW_APPS_ADDR A:0x61e14620
y.create.l HWIO_TCU_APPS_SMMU_CB5_TLBIVAL_LOW_APPS_ADDR A:0x61e15620
y.create.l HWIO_TCU_APPS_SMMU_CB6_TLBIVAL_LOW_APPS_ADDR A:0x61e16620
y.create.l HWIO_TCU_APPS_SMMU_CB7_TLBIVAL_LOW_APPS_ADDR A:0x61e17620
y.create.l HWIO_TCU_APPS_SMMU_CB8_TLBIVAL_LOW_APPS_ADDR A:0x61e18620
y.create.l HWIO_TCU_APPS_SMMU_CB9_TLBIVAL_LOW_APPS_ADDR A:0x61e19620
y.create.l HWIO_TCU_APPS_SMMU_CB10_TLBIVAL_LOW_APPS_ADDR A:0x61e1a620
y.create.l HWIO_TCU_APPS_SMMU_CB11_TLBIVAL_LOW_APPS_ADDR A:0x61e1b620
y.create.l HWIO_TCU_APPS_SMMU_CB12_TLBIVAL_LOW_APPS_ADDR A:0x61e1c620
y.create.l HWIO_TCU_APPS_SMMU_CB13_TLBIVAL_LOW_APPS_ADDR A:0x61e1d620
y.create.l HWIO_TCU_APPS_SMMU_CB14_TLBIVAL_LOW_APPS_ADDR A:0x61e1e620
y.create.l HWIO_TCU_APPS_SMMU_CB15_TLBIVAL_LOW_APPS_ADDR A:0x61e1f620
y.create.l HWIO_TCU_APPS_SMMU_CB0_TLBIVAL_HIGH_APPS_ADDR A:0x61e10624
y.create.l HWIO_TCU_APPS_SMMU_CB1_TLBIVAL_HIGH_APPS_ADDR A:0x61e11624
y.create.l HWIO_TCU_APPS_SMMU_CB2_TLBIVAL_HIGH_APPS_ADDR A:0x61e12624
y.create.l HWIO_TCU_APPS_SMMU_CB3_TLBIVAL_HIGH_APPS_ADDR A:0x61e13624
y.create.l HWIO_TCU_APPS_SMMU_CB4_TLBIVAL_HIGH_APPS_ADDR A:0x61e14624
y.create.l HWIO_TCU_APPS_SMMU_CB5_TLBIVAL_HIGH_APPS_ADDR A:0x61e15624
y.create.l HWIO_TCU_APPS_SMMU_CB6_TLBIVAL_HIGH_APPS_ADDR A:0x61e16624
y.create.l HWIO_TCU_APPS_SMMU_CB7_TLBIVAL_HIGH_APPS_ADDR A:0x61e17624
y.create.l HWIO_TCU_APPS_SMMU_CB8_TLBIVAL_HIGH_APPS_ADDR A:0x61e18624
y.create.l HWIO_TCU_APPS_SMMU_CB9_TLBIVAL_HIGH_APPS_ADDR A:0x61e19624
y.create.l HWIO_TCU_APPS_SMMU_CB10_TLBIVAL_HIGH_APPS_ADDR A:0x61e1a624
y.create.l HWIO_TCU_APPS_SMMU_CB11_TLBIVAL_HIGH_APPS_ADDR A:0x61e1b624
y.create.l HWIO_TCU_APPS_SMMU_CB12_TLBIVAL_HIGH_APPS_ADDR A:0x61e1c624
y.create.l HWIO_TCU_APPS_SMMU_CB13_TLBIVAL_HIGH_APPS_ADDR A:0x61e1d624
y.create.l HWIO_TCU_APPS_SMMU_CB14_TLBIVAL_HIGH_APPS_ADDR A:0x61e1e624
y.create.l HWIO_TCU_APPS_SMMU_CB15_TLBIVAL_HIGH_APPS_ADDR A:0x61e1f624
y.create.l HWIO_TCU_APPS_SMMU_CB0_TLBIVAAL_LOW_APPS_ADDR A:0x61e10628
y.create.l HWIO_TCU_APPS_SMMU_CB1_TLBIVAAL_LOW_APPS_ADDR A:0x61e11628
y.create.l HWIO_TCU_APPS_SMMU_CB2_TLBIVAAL_LOW_APPS_ADDR A:0x61e12628
y.create.l HWIO_TCU_APPS_SMMU_CB3_TLBIVAAL_LOW_APPS_ADDR A:0x61e13628
y.create.l HWIO_TCU_APPS_SMMU_CB4_TLBIVAAL_LOW_APPS_ADDR A:0x61e14628
y.create.l HWIO_TCU_APPS_SMMU_CB5_TLBIVAAL_LOW_APPS_ADDR A:0x61e15628
y.create.l HWIO_TCU_APPS_SMMU_CB6_TLBIVAAL_LOW_APPS_ADDR A:0x61e16628
y.create.l HWIO_TCU_APPS_SMMU_CB7_TLBIVAAL_LOW_APPS_ADDR A:0x61e17628
y.create.l HWIO_TCU_APPS_SMMU_CB8_TLBIVAAL_LOW_APPS_ADDR A:0x61e18628
y.create.l HWIO_TCU_APPS_SMMU_CB9_TLBIVAAL_LOW_APPS_ADDR A:0x61e19628
y.create.l HWIO_TCU_APPS_SMMU_CB10_TLBIVAAL_LOW_APPS_ADDR A:0x61e1a628
y.create.l HWIO_TCU_APPS_SMMU_CB11_TLBIVAAL_LOW_APPS_ADDR A:0x61e1b628
y.create.l HWIO_TCU_APPS_SMMU_CB12_TLBIVAAL_LOW_APPS_ADDR A:0x61e1c628
y.create.l HWIO_TCU_APPS_SMMU_CB13_TLBIVAAL_LOW_APPS_ADDR A:0x61e1d628
y.create.l HWIO_TCU_APPS_SMMU_CB14_TLBIVAAL_LOW_APPS_ADDR A:0x61e1e628
y.create.l HWIO_TCU_APPS_SMMU_CB15_TLBIVAAL_LOW_APPS_ADDR A:0x61e1f628
y.create.l HWIO_TCU_APPS_SMMU_CB0_TLBIVAAL_HIGH_APPS_ADDR A:0x61e1062c
y.create.l HWIO_TCU_APPS_SMMU_CB1_TLBIVAAL_HIGH_APPS_ADDR A:0x61e1162c
y.create.l HWIO_TCU_APPS_SMMU_CB2_TLBIVAAL_HIGH_APPS_ADDR A:0x61e1262c
y.create.l HWIO_TCU_APPS_SMMU_CB3_TLBIVAAL_HIGH_APPS_ADDR A:0x61e1362c
y.create.l HWIO_TCU_APPS_SMMU_CB4_TLBIVAAL_HIGH_APPS_ADDR A:0x61e1462c
y.create.l HWIO_TCU_APPS_SMMU_CB5_TLBIVAAL_HIGH_APPS_ADDR A:0x61e1562c
y.create.l HWIO_TCU_APPS_SMMU_CB6_TLBIVAAL_HIGH_APPS_ADDR A:0x61e1662c
y.create.l HWIO_TCU_APPS_SMMU_CB7_TLBIVAAL_HIGH_APPS_ADDR A:0x61e1762c
y.create.l HWIO_TCU_APPS_SMMU_CB8_TLBIVAAL_HIGH_APPS_ADDR A:0x61e1862c
y.create.l HWIO_TCU_APPS_SMMU_CB9_TLBIVAAL_HIGH_APPS_ADDR A:0x61e1962c
y.create.l HWIO_TCU_APPS_SMMU_CB10_TLBIVAAL_HIGH_APPS_ADDR A:0x61e1a62c
y.create.l HWIO_TCU_APPS_SMMU_CB11_TLBIVAAL_HIGH_APPS_ADDR A:0x61e1b62c
y.create.l HWIO_TCU_APPS_SMMU_CB12_TLBIVAAL_HIGH_APPS_ADDR A:0x61e1c62c
y.create.l HWIO_TCU_APPS_SMMU_CB13_TLBIVAAL_HIGH_APPS_ADDR A:0x61e1d62c
y.create.l HWIO_TCU_APPS_SMMU_CB14_TLBIVAAL_HIGH_APPS_ADDR A:0x61e1e62c
y.create.l HWIO_TCU_APPS_SMMU_CB15_TLBIVAAL_HIGH_APPS_ADDR A:0x61e1f62c
y.create.l HWIO_TCU_APPS_SMMU_CB0_TLBIIPAS2_LOW_APPS_ADDR A:0x61e10630
y.create.l HWIO_TCU_APPS_SMMU_CB1_TLBIIPAS2_LOW_APPS_ADDR A:0x61e11630
y.create.l HWIO_TCU_APPS_SMMU_CB2_TLBIIPAS2_LOW_APPS_ADDR A:0x61e12630
y.create.l HWIO_TCU_APPS_SMMU_CB3_TLBIIPAS2_LOW_APPS_ADDR A:0x61e13630
y.create.l HWIO_TCU_APPS_SMMU_CB4_TLBIIPAS2_LOW_APPS_ADDR A:0x61e14630
y.create.l HWIO_TCU_APPS_SMMU_CB5_TLBIIPAS2_LOW_APPS_ADDR A:0x61e15630
y.create.l HWIO_TCU_APPS_SMMU_CB6_TLBIIPAS2_LOW_APPS_ADDR A:0x61e16630
y.create.l HWIO_TCU_APPS_SMMU_CB7_TLBIIPAS2_LOW_APPS_ADDR A:0x61e17630
y.create.l HWIO_TCU_APPS_SMMU_CB8_TLBIIPAS2_LOW_APPS_ADDR A:0x61e18630
y.create.l HWIO_TCU_APPS_SMMU_CB9_TLBIIPAS2_LOW_APPS_ADDR A:0x61e19630
y.create.l HWIO_TCU_APPS_SMMU_CB10_TLBIIPAS2_LOW_APPS_ADDR A:0x61e1a630
y.create.l HWIO_TCU_APPS_SMMU_CB11_TLBIIPAS2_LOW_APPS_ADDR A:0x61e1b630
y.create.l HWIO_TCU_APPS_SMMU_CB12_TLBIIPAS2_LOW_APPS_ADDR A:0x61e1c630
y.create.l HWIO_TCU_APPS_SMMU_CB13_TLBIIPAS2_LOW_APPS_ADDR A:0x61e1d630
y.create.l HWIO_TCU_APPS_SMMU_CB14_TLBIIPAS2_LOW_APPS_ADDR A:0x61e1e630
y.create.l HWIO_TCU_APPS_SMMU_CB15_TLBIIPAS2_LOW_APPS_ADDR A:0x61e1f630
y.create.l HWIO_TCU_APPS_SMMU_CB0_TLBIIPAS2_HIGH_APPS_ADDR A:0x61e10634
y.create.l HWIO_TCU_APPS_SMMU_CB1_TLBIIPAS2_HIGH_APPS_ADDR A:0x61e11634
y.create.l HWIO_TCU_APPS_SMMU_CB2_TLBIIPAS2_HIGH_APPS_ADDR A:0x61e12634
y.create.l HWIO_TCU_APPS_SMMU_CB3_TLBIIPAS2_HIGH_APPS_ADDR A:0x61e13634
y.create.l HWIO_TCU_APPS_SMMU_CB4_TLBIIPAS2_HIGH_APPS_ADDR A:0x61e14634
y.create.l HWIO_TCU_APPS_SMMU_CB5_TLBIIPAS2_HIGH_APPS_ADDR A:0x61e15634
y.create.l HWIO_TCU_APPS_SMMU_CB6_TLBIIPAS2_HIGH_APPS_ADDR A:0x61e16634
y.create.l HWIO_TCU_APPS_SMMU_CB7_TLBIIPAS2_HIGH_APPS_ADDR A:0x61e17634
y.create.l HWIO_TCU_APPS_SMMU_CB8_TLBIIPAS2_HIGH_APPS_ADDR A:0x61e18634
y.create.l HWIO_TCU_APPS_SMMU_CB9_TLBIIPAS2_HIGH_APPS_ADDR A:0x61e19634
y.create.l HWIO_TCU_APPS_SMMU_CB10_TLBIIPAS2_HIGH_APPS_ADDR A:0x61e1a634
y.create.l HWIO_TCU_APPS_SMMU_CB11_TLBIIPAS2_HIGH_APPS_ADDR A:0x61e1b634
y.create.l HWIO_TCU_APPS_SMMU_CB12_TLBIIPAS2_HIGH_APPS_ADDR A:0x61e1c634
y.create.l HWIO_TCU_APPS_SMMU_CB13_TLBIIPAS2_HIGH_APPS_ADDR A:0x61e1d634
y.create.l HWIO_TCU_APPS_SMMU_CB14_TLBIIPAS2_HIGH_APPS_ADDR A:0x61e1e634
y.create.l HWIO_TCU_APPS_SMMU_CB15_TLBIIPAS2_HIGH_APPS_ADDR A:0x61e1f634
y.create.l HWIO_TCU_APPS_SMMU_CB0_TLBIIPAS2L_LOW_APPS_ADDR A:0x61e10638
y.create.l HWIO_TCU_APPS_SMMU_CB1_TLBIIPAS2L_LOW_APPS_ADDR A:0x61e11638
y.create.l HWIO_TCU_APPS_SMMU_CB2_TLBIIPAS2L_LOW_APPS_ADDR A:0x61e12638
y.create.l HWIO_TCU_APPS_SMMU_CB3_TLBIIPAS2L_LOW_APPS_ADDR A:0x61e13638
y.create.l HWIO_TCU_APPS_SMMU_CB4_TLBIIPAS2L_LOW_APPS_ADDR A:0x61e14638
y.create.l HWIO_TCU_APPS_SMMU_CB5_TLBIIPAS2L_LOW_APPS_ADDR A:0x61e15638
y.create.l HWIO_TCU_APPS_SMMU_CB6_TLBIIPAS2L_LOW_APPS_ADDR A:0x61e16638
y.create.l HWIO_TCU_APPS_SMMU_CB7_TLBIIPAS2L_LOW_APPS_ADDR A:0x61e17638
y.create.l HWIO_TCU_APPS_SMMU_CB8_TLBIIPAS2L_LOW_APPS_ADDR A:0x61e18638
y.create.l HWIO_TCU_APPS_SMMU_CB9_TLBIIPAS2L_LOW_APPS_ADDR A:0x61e19638
y.create.l HWIO_TCU_APPS_SMMU_CB10_TLBIIPAS2L_LOW_APPS_ADDR A:0x61e1a638
y.create.l HWIO_TCU_APPS_SMMU_CB11_TLBIIPAS2L_LOW_APPS_ADDR A:0x61e1b638
y.create.l HWIO_TCU_APPS_SMMU_CB12_TLBIIPAS2L_LOW_APPS_ADDR A:0x61e1c638
y.create.l HWIO_TCU_APPS_SMMU_CB13_TLBIIPAS2L_LOW_APPS_ADDR A:0x61e1d638
y.create.l HWIO_TCU_APPS_SMMU_CB14_TLBIIPAS2L_LOW_APPS_ADDR A:0x61e1e638
y.create.l HWIO_TCU_APPS_SMMU_CB15_TLBIIPAS2L_LOW_APPS_ADDR A:0x61e1f638
y.create.l HWIO_TCU_APPS_SMMU_CB0_TLBIIPAS2L_HIGH_APPS_ADDR A:0x61e1063c
y.create.l HWIO_TCU_APPS_SMMU_CB1_TLBIIPAS2L_HIGH_APPS_ADDR A:0x61e1163c
y.create.l HWIO_TCU_APPS_SMMU_CB2_TLBIIPAS2L_HIGH_APPS_ADDR A:0x61e1263c
y.create.l HWIO_TCU_APPS_SMMU_CB3_TLBIIPAS2L_HIGH_APPS_ADDR A:0x61e1363c
y.create.l HWIO_TCU_APPS_SMMU_CB4_TLBIIPAS2L_HIGH_APPS_ADDR A:0x61e1463c
y.create.l HWIO_TCU_APPS_SMMU_CB5_TLBIIPAS2L_HIGH_APPS_ADDR A:0x61e1563c
y.create.l HWIO_TCU_APPS_SMMU_CB6_TLBIIPAS2L_HIGH_APPS_ADDR A:0x61e1663c
y.create.l HWIO_TCU_APPS_SMMU_CB7_TLBIIPAS2L_HIGH_APPS_ADDR A:0x61e1763c
y.create.l HWIO_TCU_APPS_SMMU_CB8_TLBIIPAS2L_HIGH_APPS_ADDR A:0x61e1863c
y.create.l HWIO_TCU_APPS_SMMU_CB9_TLBIIPAS2L_HIGH_APPS_ADDR A:0x61e1963c
y.create.l HWIO_TCU_APPS_SMMU_CB10_TLBIIPAS2L_HIGH_APPS_ADDR A:0x61e1a63c
y.create.l HWIO_TCU_APPS_SMMU_CB11_TLBIIPAS2L_HIGH_APPS_ADDR A:0x61e1b63c
y.create.l HWIO_TCU_APPS_SMMU_CB12_TLBIIPAS2L_HIGH_APPS_ADDR A:0x61e1c63c
y.create.l HWIO_TCU_APPS_SMMU_CB13_TLBIIPAS2L_HIGH_APPS_ADDR A:0x61e1d63c
y.create.l HWIO_TCU_APPS_SMMU_CB14_TLBIIPAS2L_HIGH_APPS_ADDR A:0x61e1e63c
y.create.l HWIO_TCU_APPS_SMMU_CB15_TLBIIPAS2L_HIGH_APPS_ADDR A:0x61e1f63c
y.create.l HWIO_TCU_APPS_SMMU_CB0_TLBSYNC_APPS_ADDR A:0x61e107f0
y.create.l HWIO_TCU_APPS_SMMU_CB1_TLBSYNC_APPS_ADDR A:0x61e117f0
y.create.l HWIO_TCU_APPS_SMMU_CB2_TLBSYNC_APPS_ADDR A:0x61e127f0
y.create.l HWIO_TCU_APPS_SMMU_CB3_TLBSYNC_APPS_ADDR A:0x61e137f0
y.create.l HWIO_TCU_APPS_SMMU_CB4_TLBSYNC_APPS_ADDR A:0x61e147f0
y.create.l HWIO_TCU_APPS_SMMU_CB5_TLBSYNC_APPS_ADDR A:0x61e157f0
y.create.l HWIO_TCU_APPS_SMMU_CB6_TLBSYNC_APPS_ADDR A:0x61e167f0
y.create.l HWIO_TCU_APPS_SMMU_CB7_TLBSYNC_APPS_ADDR A:0x61e177f0
y.create.l HWIO_TCU_APPS_SMMU_CB8_TLBSYNC_APPS_ADDR A:0x61e187f0
y.create.l HWIO_TCU_APPS_SMMU_CB9_TLBSYNC_APPS_ADDR A:0x61e197f0
y.create.l HWIO_TCU_APPS_SMMU_CB10_TLBSYNC_APPS_ADDR A:0x61e1a7f0
y.create.l HWIO_TCU_APPS_SMMU_CB11_TLBSYNC_APPS_ADDR A:0x61e1b7f0
y.create.l HWIO_TCU_APPS_SMMU_CB12_TLBSYNC_APPS_ADDR A:0x61e1c7f0
y.create.l HWIO_TCU_APPS_SMMU_CB13_TLBSYNC_APPS_ADDR A:0x61e1d7f0
y.create.l HWIO_TCU_APPS_SMMU_CB14_TLBSYNC_APPS_ADDR A:0x61e1e7f0
y.create.l HWIO_TCU_APPS_SMMU_CB15_TLBSYNC_APPS_ADDR A:0x61e1f7f0
y.create.l HWIO_TCU_APPS_SMMU_CB0_TLBSTATUS_APPS_ADDR A:0x61e107f4
y.create.l HWIO_TCU_APPS_SMMU_CB1_TLBSTATUS_APPS_ADDR A:0x61e117f4
y.create.l HWIO_TCU_APPS_SMMU_CB2_TLBSTATUS_APPS_ADDR A:0x61e127f4
y.create.l HWIO_TCU_APPS_SMMU_CB3_TLBSTATUS_APPS_ADDR A:0x61e137f4
y.create.l HWIO_TCU_APPS_SMMU_CB4_TLBSTATUS_APPS_ADDR A:0x61e147f4
y.create.l HWIO_TCU_APPS_SMMU_CB5_TLBSTATUS_APPS_ADDR A:0x61e157f4
y.create.l HWIO_TCU_APPS_SMMU_CB6_TLBSTATUS_APPS_ADDR A:0x61e167f4
y.create.l HWIO_TCU_APPS_SMMU_CB7_TLBSTATUS_APPS_ADDR A:0x61e177f4
y.create.l HWIO_TCU_APPS_SMMU_CB8_TLBSTATUS_APPS_ADDR A:0x61e187f4
y.create.l HWIO_TCU_APPS_SMMU_CB9_TLBSTATUS_APPS_ADDR A:0x61e197f4
y.create.l HWIO_TCU_APPS_SMMU_CB10_TLBSTATUS_APPS_ADDR A:0x61e1a7f4
y.create.l HWIO_TCU_APPS_SMMU_CB11_TLBSTATUS_APPS_ADDR A:0x61e1b7f4
y.create.l HWIO_TCU_APPS_SMMU_CB12_TLBSTATUS_APPS_ADDR A:0x61e1c7f4
y.create.l HWIO_TCU_APPS_SMMU_CB13_TLBSTATUS_APPS_ADDR A:0x61e1d7f4
y.create.l HWIO_TCU_APPS_SMMU_CB14_TLBSTATUS_APPS_ADDR A:0x61e1e7f4
y.create.l HWIO_TCU_APPS_SMMU_CB15_TLBSTATUS_APPS_ADDR A:0x61e1f7f4
y.create.l HWIO_TCU_APPS_SMMU_CB0_PMEVCNTR0_APPS_ADDR A:0x61e10e00
y.create.l HWIO_TCU_APPS_SMMU_CB1_PMEVCNTR0_APPS_ADDR A:0x61e11e00
y.create.l HWIO_TCU_APPS_SMMU_CB2_PMEVCNTR0_APPS_ADDR A:0x61e12e00
y.create.l HWIO_TCU_APPS_SMMU_CB3_PMEVCNTR0_APPS_ADDR A:0x61e13e00
y.create.l HWIO_TCU_APPS_SMMU_CB4_PMEVCNTR0_APPS_ADDR A:0x61e14e00
y.create.l HWIO_TCU_APPS_SMMU_CB5_PMEVCNTR0_APPS_ADDR A:0x61e15e00
y.create.l HWIO_TCU_APPS_SMMU_CB6_PMEVCNTR0_APPS_ADDR A:0x61e16e00
y.create.l HWIO_TCU_APPS_SMMU_CB7_PMEVCNTR0_APPS_ADDR A:0x61e17e00
y.create.l HWIO_TCU_APPS_SMMU_CB8_PMEVCNTR0_APPS_ADDR A:0x61e18e00
y.create.l HWIO_TCU_APPS_SMMU_CB9_PMEVCNTR0_APPS_ADDR A:0x61e19e00
y.create.l HWIO_TCU_APPS_SMMU_CB10_PMEVCNTR0_APPS_ADDR A:0x61e1ae00
y.create.l HWIO_TCU_APPS_SMMU_CB11_PMEVCNTR0_APPS_ADDR A:0x61e1be00
y.create.l HWIO_TCU_APPS_SMMU_CB12_PMEVCNTR0_APPS_ADDR A:0x61e1ce00
y.create.l HWIO_TCU_APPS_SMMU_CB13_PMEVCNTR0_APPS_ADDR A:0x61e1de00
y.create.l HWIO_TCU_APPS_SMMU_CB14_PMEVCNTR0_APPS_ADDR A:0x61e1ee00
y.create.l HWIO_TCU_APPS_SMMU_CB15_PMEVCNTR0_APPS_ADDR A:0x61e1fe00
y.create.l HWIO_TCU_APPS_SMMU_CB0_PMEVCNTR1_APPS_ADDR A:0x61e10e04
y.create.l HWIO_TCU_APPS_SMMU_CB1_PMEVCNTR1_APPS_ADDR A:0x61e11e04
y.create.l HWIO_TCU_APPS_SMMU_CB2_PMEVCNTR1_APPS_ADDR A:0x61e12e04
y.create.l HWIO_TCU_APPS_SMMU_CB3_PMEVCNTR1_APPS_ADDR A:0x61e13e04
y.create.l HWIO_TCU_APPS_SMMU_CB4_PMEVCNTR1_APPS_ADDR A:0x61e14e04
y.create.l HWIO_TCU_APPS_SMMU_CB5_PMEVCNTR1_APPS_ADDR A:0x61e15e04
y.create.l HWIO_TCU_APPS_SMMU_CB6_PMEVCNTR1_APPS_ADDR A:0x61e16e04
y.create.l HWIO_TCU_APPS_SMMU_CB7_PMEVCNTR1_APPS_ADDR A:0x61e17e04
y.create.l HWIO_TCU_APPS_SMMU_CB8_PMEVCNTR1_APPS_ADDR A:0x61e18e04
y.create.l HWIO_TCU_APPS_SMMU_CB9_PMEVCNTR1_APPS_ADDR A:0x61e19e04
y.create.l HWIO_TCU_APPS_SMMU_CB10_PMEVCNTR1_APPS_ADDR A:0x61e1ae04
y.create.l HWIO_TCU_APPS_SMMU_CB11_PMEVCNTR1_APPS_ADDR A:0x61e1be04
y.create.l HWIO_TCU_APPS_SMMU_CB12_PMEVCNTR1_APPS_ADDR A:0x61e1ce04
y.create.l HWIO_TCU_APPS_SMMU_CB13_PMEVCNTR1_APPS_ADDR A:0x61e1de04
y.create.l HWIO_TCU_APPS_SMMU_CB14_PMEVCNTR1_APPS_ADDR A:0x61e1ee04
y.create.l HWIO_TCU_APPS_SMMU_CB15_PMEVCNTR1_APPS_ADDR A:0x61e1fe04
y.create.l HWIO_TCU_APPS_SMMU_CB0_PMEVCNTR2_APPS_ADDR A:0x61e10e08
y.create.l HWIO_TCU_APPS_SMMU_CB1_PMEVCNTR2_APPS_ADDR A:0x61e11e08
y.create.l HWIO_TCU_APPS_SMMU_CB2_PMEVCNTR2_APPS_ADDR A:0x61e12e08
y.create.l HWIO_TCU_APPS_SMMU_CB3_PMEVCNTR2_APPS_ADDR A:0x61e13e08
y.create.l HWIO_TCU_APPS_SMMU_CB4_PMEVCNTR2_APPS_ADDR A:0x61e14e08
y.create.l HWIO_TCU_APPS_SMMU_CB5_PMEVCNTR2_APPS_ADDR A:0x61e15e08
y.create.l HWIO_TCU_APPS_SMMU_CB6_PMEVCNTR2_APPS_ADDR A:0x61e16e08
y.create.l HWIO_TCU_APPS_SMMU_CB7_PMEVCNTR2_APPS_ADDR A:0x61e17e08
y.create.l HWIO_TCU_APPS_SMMU_CB8_PMEVCNTR2_APPS_ADDR A:0x61e18e08
y.create.l HWIO_TCU_APPS_SMMU_CB9_PMEVCNTR2_APPS_ADDR A:0x61e19e08
y.create.l HWIO_TCU_APPS_SMMU_CB10_PMEVCNTR2_APPS_ADDR A:0x61e1ae08
y.create.l HWIO_TCU_APPS_SMMU_CB11_PMEVCNTR2_APPS_ADDR A:0x61e1be08
y.create.l HWIO_TCU_APPS_SMMU_CB12_PMEVCNTR2_APPS_ADDR A:0x61e1ce08
y.create.l HWIO_TCU_APPS_SMMU_CB13_PMEVCNTR2_APPS_ADDR A:0x61e1de08
y.create.l HWIO_TCU_APPS_SMMU_CB14_PMEVCNTR2_APPS_ADDR A:0x61e1ee08
y.create.l HWIO_TCU_APPS_SMMU_CB15_PMEVCNTR2_APPS_ADDR A:0x61e1fe08
y.create.l HWIO_TCU_APPS_SMMU_CB0_PMEVCNTR3_APPS_ADDR A:0x61e10e0c
y.create.l HWIO_TCU_APPS_SMMU_CB1_PMEVCNTR3_APPS_ADDR A:0x61e11e0c
y.create.l HWIO_TCU_APPS_SMMU_CB2_PMEVCNTR3_APPS_ADDR A:0x61e12e0c
y.create.l HWIO_TCU_APPS_SMMU_CB3_PMEVCNTR3_APPS_ADDR A:0x61e13e0c
y.create.l HWIO_TCU_APPS_SMMU_CB4_PMEVCNTR3_APPS_ADDR A:0x61e14e0c
y.create.l HWIO_TCU_APPS_SMMU_CB5_PMEVCNTR3_APPS_ADDR A:0x61e15e0c
y.create.l HWIO_TCU_APPS_SMMU_CB6_PMEVCNTR3_APPS_ADDR A:0x61e16e0c
y.create.l HWIO_TCU_APPS_SMMU_CB7_PMEVCNTR3_APPS_ADDR A:0x61e17e0c
y.create.l HWIO_TCU_APPS_SMMU_CB8_PMEVCNTR3_APPS_ADDR A:0x61e18e0c
y.create.l HWIO_TCU_APPS_SMMU_CB9_PMEVCNTR3_APPS_ADDR A:0x61e19e0c
y.create.l HWIO_TCU_APPS_SMMU_CB10_PMEVCNTR3_APPS_ADDR A:0x61e1ae0c
y.create.l HWIO_TCU_APPS_SMMU_CB11_PMEVCNTR3_APPS_ADDR A:0x61e1be0c
y.create.l HWIO_TCU_APPS_SMMU_CB12_PMEVCNTR3_APPS_ADDR A:0x61e1ce0c
y.create.l HWIO_TCU_APPS_SMMU_CB13_PMEVCNTR3_APPS_ADDR A:0x61e1de0c
y.create.l HWIO_TCU_APPS_SMMU_CB14_PMEVCNTR3_APPS_ADDR A:0x61e1ee0c
y.create.l HWIO_TCU_APPS_SMMU_CB15_PMEVCNTR3_APPS_ADDR A:0x61e1fe0c
y.create.l HWIO_TCU_APPS_SMMU_CB0_PMEVTYPER0_APPS_ADDR A:0x61e10e80
y.create.l HWIO_TCU_APPS_SMMU_CB1_PMEVTYPER0_APPS_ADDR A:0x61e11e80
y.create.l HWIO_TCU_APPS_SMMU_CB2_PMEVTYPER0_APPS_ADDR A:0x61e12e80
y.create.l HWIO_TCU_APPS_SMMU_CB3_PMEVTYPER0_APPS_ADDR A:0x61e13e80
y.create.l HWIO_TCU_APPS_SMMU_CB4_PMEVTYPER0_APPS_ADDR A:0x61e14e80
y.create.l HWIO_TCU_APPS_SMMU_CB5_PMEVTYPER0_APPS_ADDR A:0x61e15e80
y.create.l HWIO_TCU_APPS_SMMU_CB6_PMEVTYPER0_APPS_ADDR A:0x61e16e80
y.create.l HWIO_TCU_APPS_SMMU_CB7_PMEVTYPER0_APPS_ADDR A:0x61e17e80
y.create.l HWIO_TCU_APPS_SMMU_CB8_PMEVTYPER0_APPS_ADDR A:0x61e18e80
y.create.l HWIO_TCU_APPS_SMMU_CB9_PMEVTYPER0_APPS_ADDR A:0x61e19e80
y.create.l HWIO_TCU_APPS_SMMU_CB10_PMEVTYPER0_APPS_ADDR A:0x61e1ae80
y.create.l HWIO_TCU_APPS_SMMU_CB11_PMEVTYPER0_APPS_ADDR A:0x61e1be80
y.create.l HWIO_TCU_APPS_SMMU_CB12_PMEVTYPER0_APPS_ADDR A:0x61e1ce80
y.create.l HWIO_TCU_APPS_SMMU_CB13_PMEVTYPER0_APPS_ADDR A:0x61e1de80
y.create.l HWIO_TCU_APPS_SMMU_CB14_PMEVTYPER0_APPS_ADDR A:0x61e1ee80
y.create.l HWIO_TCU_APPS_SMMU_CB15_PMEVTYPER0_APPS_ADDR A:0x61e1fe80
y.create.l HWIO_TCU_APPS_SMMU_CB0_PMEVTYPER1_APPS_ADDR A:0x61e10e84
y.create.l HWIO_TCU_APPS_SMMU_CB1_PMEVTYPER1_APPS_ADDR A:0x61e11e84
y.create.l HWIO_TCU_APPS_SMMU_CB2_PMEVTYPER1_APPS_ADDR A:0x61e12e84
y.create.l HWIO_TCU_APPS_SMMU_CB3_PMEVTYPER1_APPS_ADDR A:0x61e13e84
y.create.l HWIO_TCU_APPS_SMMU_CB4_PMEVTYPER1_APPS_ADDR A:0x61e14e84
y.create.l HWIO_TCU_APPS_SMMU_CB5_PMEVTYPER1_APPS_ADDR A:0x61e15e84
y.create.l HWIO_TCU_APPS_SMMU_CB6_PMEVTYPER1_APPS_ADDR A:0x61e16e84
y.create.l HWIO_TCU_APPS_SMMU_CB7_PMEVTYPER1_APPS_ADDR A:0x61e17e84
y.create.l HWIO_TCU_APPS_SMMU_CB8_PMEVTYPER1_APPS_ADDR A:0x61e18e84
y.create.l HWIO_TCU_APPS_SMMU_CB9_PMEVTYPER1_APPS_ADDR A:0x61e19e84
y.create.l HWIO_TCU_APPS_SMMU_CB10_PMEVTYPER1_APPS_ADDR A:0x61e1ae84
y.create.l HWIO_TCU_APPS_SMMU_CB11_PMEVTYPER1_APPS_ADDR A:0x61e1be84
y.create.l HWIO_TCU_APPS_SMMU_CB12_PMEVTYPER1_APPS_ADDR A:0x61e1ce84
y.create.l HWIO_TCU_APPS_SMMU_CB13_PMEVTYPER1_APPS_ADDR A:0x61e1de84
y.create.l HWIO_TCU_APPS_SMMU_CB14_PMEVTYPER1_APPS_ADDR A:0x61e1ee84
y.create.l HWIO_TCU_APPS_SMMU_CB15_PMEVTYPER1_APPS_ADDR A:0x61e1fe84
y.create.l HWIO_TCU_APPS_SMMU_CB0_PMEVTYPER2_APPS_ADDR A:0x61e10e88
y.create.l HWIO_TCU_APPS_SMMU_CB1_PMEVTYPER2_APPS_ADDR A:0x61e11e88
y.create.l HWIO_TCU_APPS_SMMU_CB2_PMEVTYPER2_APPS_ADDR A:0x61e12e88
y.create.l HWIO_TCU_APPS_SMMU_CB3_PMEVTYPER2_APPS_ADDR A:0x61e13e88
y.create.l HWIO_TCU_APPS_SMMU_CB4_PMEVTYPER2_APPS_ADDR A:0x61e14e88
y.create.l HWIO_TCU_APPS_SMMU_CB5_PMEVTYPER2_APPS_ADDR A:0x61e15e88
y.create.l HWIO_TCU_APPS_SMMU_CB6_PMEVTYPER2_APPS_ADDR A:0x61e16e88
y.create.l HWIO_TCU_APPS_SMMU_CB7_PMEVTYPER2_APPS_ADDR A:0x61e17e88
y.create.l HWIO_TCU_APPS_SMMU_CB8_PMEVTYPER2_APPS_ADDR A:0x61e18e88
y.create.l HWIO_TCU_APPS_SMMU_CB9_PMEVTYPER2_APPS_ADDR A:0x61e19e88
y.create.l HWIO_TCU_APPS_SMMU_CB10_PMEVTYPER2_APPS_ADDR A:0x61e1ae88
y.create.l HWIO_TCU_APPS_SMMU_CB11_PMEVTYPER2_APPS_ADDR A:0x61e1be88
y.create.l HWIO_TCU_APPS_SMMU_CB12_PMEVTYPER2_APPS_ADDR A:0x61e1ce88
y.create.l HWIO_TCU_APPS_SMMU_CB13_PMEVTYPER2_APPS_ADDR A:0x61e1de88
y.create.l HWIO_TCU_APPS_SMMU_CB14_PMEVTYPER2_APPS_ADDR A:0x61e1ee88
y.create.l HWIO_TCU_APPS_SMMU_CB15_PMEVTYPER2_APPS_ADDR A:0x61e1fe88
y.create.l HWIO_TCU_APPS_SMMU_CB0_PMEVTYPER3_APPS_ADDR A:0x61e10e8c
y.create.l HWIO_TCU_APPS_SMMU_CB1_PMEVTYPER3_APPS_ADDR A:0x61e11e8c
y.create.l HWIO_TCU_APPS_SMMU_CB2_PMEVTYPER3_APPS_ADDR A:0x61e12e8c
y.create.l HWIO_TCU_APPS_SMMU_CB3_PMEVTYPER3_APPS_ADDR A:0x61e13e8c
y.create.l HWIO_TCU_APPS_SMMU_CB4_PMEVTYPER3_APPS_ADDR A:0x61e14e8c
y.create.l HWIO_TCU_APPS_SMMU_CB5_PMEVTYPER3_APPS_ADDR A:0x61e15e8c
y.create.l HWIO_TCU_APPS_SMMU_CB6_PMEVTYPER3_APPS_ADDR A:0x61e16e8c
y.create.l HWIO_TCU_APPS_SMMU_CB7_PMEVTYPER3_APPS_ADDR A:0x61e17e8c
y.create.l HWIO_TCU_APPS_SMMU_CB8_PMEVTYPER3_APPS_ADDR A:0x61e18e8c
y.create.l HWIO_TCU_APPS_SMMU_CB9_PMEVTYPER3_APPS_ADDR A:0x61e19e8c
y.create.l HWIO_TCU_APPS_SMMU_CB10_PMEVTYPER3_APPS_ADDR A:0x61e1ae8c
y.create.l HWIO_TCU_APPS_SMMU_CB11_PMEVTYPER3_APPS_ADDR A:0x61e1be8c
y.create.l HWIO_TCU_APPS_SMMU_CB12_PMEVTYPER3_APPS_ADDR A:0x61e1ce8c
y.create.l HWIO_TCU_APPS_SMMU_CB13_PMEVTYPER3_APPS_ADDR A:0x61e1de8c
y.create.l HWIO_TCU_APPS_SMMU_CB14_PMEVTYPER3_APPS_ADDR A:0x61e1ee8c
y.create.l HWIO_TCU_APPS_SMMU_CB15_PMEVTYPER3_APPS_ADDR A:0x61e1fe8c
y.create.l HWIO_TCU_APPS_SMMU_CB0_PMCFGR_APPS_ADDR A:0x61e10f00
y.create.l HWIO_TCU_APPS_SMMU_CB1_PMCFGR_APPS_ADDR A:0x61e11f00
y.create.l HWIO_TCU_APPS_SMMU_CB2_PMCFGR_APPS_ADDR A:0x61e12f00
y.create.l HWIO_TCU_APPS_SMMU_CB3_PMCFGR_APPS_ADDR A:0x61e13f00
y.create.l HWIO_TCU_APPS_SMMU_CB4_PMCFGR_APPS_ADDR A:0x61e14f00
y.create.l HWIO_TCU_APPS_SMMU_CB5_PMCFGR_APPS_ADDR A:0x61e15f00
y.create.l HWIO_TCU_APPS_SMMU_CB6_PMCFGR_APPS_ADDR A:0x61e16f00
y.create.l HWIO_TCU_APPS_SMMU_CB7_PMCFGR_APPS_ADDR A:0x61e17f00
y.create.l HWIO_TCU_APPS_SMMU_CB8_PMCFGR_APPS_ADDR A:0x61e18f00
y.create.l HWIO_TCU_APPS_SMMU_CB9_PMCFGR_APPS_ADDR A:0x61e19f00
y.create.l HWIO_TCU_APPS_SMMU_CB10_PMCFGR_APPS_ADDR A:0x61e1af00
y.create.l HWIO_TCU_APPS_SMMU_CB11_PMCFGR_APPS_ADDR A:0x61e1bf00
y.create.l HWIO_TCU_APPS_SMMU_CB12_PMCFGR_APPS_ADDR A:0x61e1cf00
y.create.l HWIO_TCU_APPS_SMMU_CB13_PMCFGR_APPS_ADDR A:0x61e1df00
y.create.l HWIO_TCU_APPS_SMMU_CB14_PMCFGR_APPS_ADDR A:0x61e1ef00
y.create.l HWIO_TCU_APPS_SMMU_CB15_PMCFGR_APPS_ADDR A:0x61e1ff00
y.create.l HWIO_TCU_APPS_SMMU_CB0_PMCR_APPS_ADDR A:0x61e10f04
y.create.l HWIO_TCU_APPS_SMMU_CB1_PMCR_APPS_ADDR A:0x61e11f04
y.create.l HWIO_TCU_APPS_SMMU_CB2_PMCR_APPS_ADDR A:0x61e12f04
y.create.l HWIO_TCU_APPS_SMMU_CB3_PMCR_APPS_ADDR A:0x61e13f04
y.create.l HWIO_TCU_APPS_SMMU_CB4_PMCR_APPS_ADDR A:0x61e14f04
y.create.l HWIO_TCU_APPS_SMMU_CB5_PMCR_APPS_ADDR A:0x61e15f04
y.create.l HWIO_TCU_APPS_SMMU_CB6_PMCR_APPS_ADDR A:0x61e16f04
y.create.l HWIO_TCU_APPS_SMMU_CB7_PMCR_APPS_ADDR A:0x61e17f04
y.create.l HWIO_TCU_APPS_SMMU_CB8_PMCR_APPS_ADDR A:0x61e18f04
y.create.l HWIO_TCU_APPS_SMMU_CB9_PMCR_APPS_ADDR A:0x61e19f04
y.create.l HWIO_TCU_APPS_SMMU_CB10_PMCR_APPS_ADDR A:0x61e1af04
y.create.l HWIO_TCU_APPS_SMMU_CB11_PMCR_APPS_ADDR A:0x61e1bf04
y.create.l HWIO_TCU_APPS_SMMU_CB12_PMCR_APPS_ADDR A:0x61e1cf04
y.create.l HWIO_TCU_APPS_SMMU_CB13_PMCR_APPS_ADDR A:0x61e1df04
y.create.l HWIO_TCU_APPS_SMMU_CB14_PMCR_APPS_ADDR A:0x61e1ef04
y.create.l HWIO_TCU_APPS_SMMU_CB15_PMCR_APPS_ADDR A:0x61e1ff04
y.create.l HWIO_TCU_APPS_SMMU_CB0_PMCEID_APPS_ADDR A:0x61e10f20
y.create.l HWIO_TCU_APPS_SMMU_CB1_PMCEID_APPS_ADDR A:0x61e11f20
y.create.l HWIO_TCU_APPS_SMMU_CB2_PMCEID_APPS_ADDR A:0x61e12f20
y.create.l HWIO_TCU_APPS_SMMU_CB3_PMCEID_APPS_ADDR A:0x61e13f20
y.create.l HWIO_TCU_APPS_SMMU_CB4_PMCEID_APPS_ADDR A:0x61e14f20
y.create.l HWIO_TCU_APPS_SMMU_CB5_PMCEID_APPS_ADDR A:0x61e15f20
y.create.l HWIO_TCU_APPS_SMMU_CB6_PMCEID_APPS_ADDR A:0x61e16f20
y.create.l HWIO_TCU_APPS_SMMU_CB7_PMCEID_APPS_ADDR A:0x61e17f20
y.create.l HWIO_TCU_APPS_SMMU_CB8_PMCEID_APPS_ADDR A:0x61e18f20
y.create.l HWIO_TCU_APPS_SMMU_CB9_PMCEID_APPS_ADDR A:0x61e19f20
y.create.l HWIO_TCU_APPS_SMMU_CB10_PMCEID_APPS_ADDR A:0x61e1af20
y.create.l HWIO_TCU_APPS_SMMU_CB11_PMCEID_APPS_ADDR A:0x61e1bf20
y.create.l HWIO_TCU_APPS_SMMU_CB12_PMCEID_APPS_ADDR A:0x61e1cf20
y.create.l HWIO_TCU_APPS_SMMU_CB13_PMCEID_APPS_ADDR A:0x61e1df20
y.create.l HWIO_TCU_APPS_SMMU_CB14_PMCEID_APPS_ADDR A:0x61e1ef20
y.create.l HWIO_TCU_APPS_SMMU_CB15_PMCEID_APPS_ADDR A:0x61e1ff20
y.create.l HWIO_TCU_APPS_SMMU_CB0_PMCNTENSE_APPS_ADDR A:0x61e10f40
y.create.l HWIO_TCU_APPS_SMMU_CB1_PMCNTENSE_APPS_ADDR A:0x61e11f40
y.create.l HWIO_TCU_APPS_SMMU_CB2_PMCNTENSE_APPS_ADDR A:0x61e12f40
y.create.l HWIO_TCU_APPS_SMMU_CB3_PMCNTENSE_APPS_ADDR A:0x61e13f40
y.create.l HWIO_TCU_APPS_SMMU_CB4_PMCNTENSE_APPS_ADDR A:0x61e14f40
y.create.l HWIO_TCU_APPS_SMMU_CB5_PMCNTENSE_APPS_ADDR A:0x61e15f40
y.create.l HWIO_TCU_APPS_SMMU_CB6_PMCNTENSE_APPS_ADDR A:0x61e16f40
y.create.l HWIO_TCU_APPS_SMMU_CB7_PMCNTENSE_APPS_ADDR A:0x61e17f40
y.create.l HWIO_TCU_APPS_SMMU_CB8_PMCNTENSE_APPS_ADDR A:0x61e18f40
y.create.l HWIO_TCU_APPS_SMMU_CB9_PMCNTENSE_APPS_ADDR A:0x61e19f40
y.create.l HWIO_TCU_APPS_SMMU_CB10_PMCNTENSE_APPS_ADDR A:0x61e1af40
y.create.l HWIO_TCU_APPS_SMMU_CB11_PMCNTENSE_APPS_ADDR A:0x61e1bf40
y.create.l HWIO_TCU_APPS_SMMU_CB12_PMCNTENSE_APPS_ADDR A:0x61e1cf40
y.create.l HWIO_TCU_APPS_SMMU_CB13_PMCNTENSE_APPS_ADDR A:0x61e1df40
y.create.l HWIO_TCU_APPS_SMMU_CB14_PMCNTENSE_APPS_ADDR A:0x61e1ef40
y.create.l HWIO_TCU_APPS_SMMU_CB15_PMCNTENSE_APPS_ADDR A:0x61e1ff40
y.create.l HWIO_TCU_APPS_SMMU_CB0_PMCNTENCLR_APPS_ADDR A:0x61e10f44
y.create.l HWIO_TCU_APPS_SMMU_CB1_PMCNTENCLR_APPS_ADDR A:0x61e11f44
y.create.l HWIO_TCU_APPS_SMMU_CB2_PMCNTENCLR_APPS_ADDR A:0x61e12f44
y.create.l HWIO_TCU_APPS_SMMU_CB3_PMCNTENCLR_APPS_ADDR A:0x61e13f44
y.create.l HWIO_TCU_APPS_SMMU_CB4_PMCNTENCLR_APPS_ADDR A:0x61e14f44
y.create.l HWIO_TCU_APPS_SMMU_CB5_PMCNTENCLR_APPS_ADDR A:0x61e15f44
y.create.l HWIO_TCU_APPS_SMMU_CB6_PMCNTENCLR_APPS_ADDR A:0x61e16f44
y.create.l HWIO_TCU_APPS_SMMU_CB7_PMCNTENCLR_APPS_ADDR A:0x61e17f44
y.create.l HWIO_TCU_APPS_SMMU_CB8_PMCNTENCLR_APPS_ADDR A:0x61e18f44
y.create.l HWIO_TCU_APPS_SMMU_CB9_PMCNTENCLR_APPS_ADDR A:0x61e19f44
y.create.l HWIO_TCU_APPS_SMMU_CB10_PMCNTENCLR_APPS_ADDR A:0x61e1af44
y.create.l HWIO_TCU_APPS_SMMU_CB11_PMCNTENCLR_APPS_ADDR A:0x61e1bf44
y.create.l HWIO_TCU_APPS_SMMU_CB12_PMCNTENCLR_APPS_ADDR A:0x61e1cf44
y.create.l HWIO_TCU_APPS_SMMU_CB13_PMCNTENCLR_APPS_ADDR A:0x61e1df44
y.create.l HWIO_TCU_APPS_SMMU_CB14_PMCNTENCLR_APPS_ADDR A:0x61e1ef44
y.create.l HWIO_TCU_APPS_SMMU_CB15_PMCNTENCLR_APPS_ADDR A:0x61e1ff44
y.create.l HWIO_TCU_APPS_SMMU_CB0_PMCNTENSET_APPS_ADDR A:0x61e10f48
y.create.l HWIO_TCU_APPS_SMMU_CB1_PMCNTENSET_APPS_ADDR A:0x61e11f48
y.create.l HWIO_TCU_APPS_SMMU_CB2_PMCNTENSET_APPS_ADDR A:0x61e12f48
y.create.l HWIO_TCU_APPS_SMMU_CB3_PMCNTENSET_APPS_ADDR A:0x61e13f48
y.create.l HWIO_TCU_APPS_SMMU_CB4_PMCNTENSET_APPS_ADDR A:0x61e14f48
y.create.l HWIO_TCU_APPS_SMMU_CB5_PMCNTENSET_APPS_ADDR A:0x61e15f48
y.create.l HWIO_TCU_APPS_SMMU_CB6_PMCNTENSET_APPS_ADDR A:0x61e16f48
y.create.l HWIO_TCU_APPS_SMMU_CB7_PMCNTENSET_APPS_ADDR A:0x61e17f48
y.create.l HWIO_TCU_APPS_SMMU_CB8_PMCNTENSET_APPS_ADDR A:0x61e18f48
y.create.l HWIO_TCU_APPS_SMMU_CB9_PMCNTENSET_APPS_ADDR A:0x61e19f48
y.create.l HWIO_TCU_APPS_SMMU_CB10_PMCNTENSET_APPS_ADDR A:0x61e1af48
y.create.l HWIO_TCU_APPS_SMMU_CB11_PMCNTENSET_APPS_ADDR A:0x61e1bf48
y.create.l HWIO_TCU_APPS_SMMU_CB12_PMCNTENSET_APPS_ADDR A:0x61e1cf48
y.create.l HWIO_TCU_APPS_SMMU_CB13_PMCNTENSET_APPS_ADDR A:0x61e1df48
y.create.l HWIO_TCU_APPS_SMMU_CB14_PMCNTENSET_APPS_ADDR A:0x61e1ef48
y.create.l HWIO_TCU_APPS_SMMU_CB15_PMCNTENSET_APPS_ADDR A:0x61e1ff48
y.create.l HWIO_TCU_APPS_SMMU_CB0_PMINTENCLR_APPS_ADDR A:0x61e10f4c
y.create.l HWIO_TCU_APPS_SMMU_CB1_PMINTENCLR_APPS_ADDR A:0x61e11f4c
y.create.l HWIO_TCU_APPS_SMMU_CB2_PMINTENCLR_APPS_ADDR A:0x61e12f4c
y.create.l HWIO_TCU_APPS_SMMU_CB3_PMINTENCLR_APPS_ADDR A:0x61e13f4c
y.create.l HWIO_TCU_APPS_SMMU_CB4_PMINTENCLR_APPS_ADDR A:0x61e14f4c
y.create.l HWIO_TCU_APPS_SMMU_CB5_PMINTENCLR_APPS_ADDR A:0x61e15f4c
y.create.l HWIO_TCU_APPS_SMMU_CB6_PMINTENCLR_APPS_ADDR A:0x61e16f4c
y.create.l HWIO_TCU_APPS_SMMU_CB7_PMINTENCLR_APPS_ADDR A:0x61e17f4c
y.create.l HWIO_TCU_APPS_SMMU_CB8_PMINTENCLR_APPS_ADDR A:0x61e18f4c
y.create.l HWIO_TCU_APPS_SMMU_CB9_PMINTENCLR_APPS_ADDR A:0x61e19f4c
y.create.l HWIO_TCU_APPS_SMMU_CB10_PMINTENCLR_APPS_ADDR A:0x61e1af4c
y.create.l HWIO_TCU_APPS_SMMU_CB11_PMINTENCLR_APPS_ADDR A:0x61e1bf4c
y.create.l HWIO_TCU_APPS_SMMU_CB12_PMINTENCLR_APPS_ADDR A:0x61e1cf4c
y.create.l HWIO_TCU_APPS_SMMU_CB13_PMINTENCLR_APPS_ADDR A:0x61e1df4c
y.create.l HWIO_TCU_APPS_SMMU_CB14_PMINTENCLR_APPS_ADDR A:0x61e1ef4c
y.create.l HWIO_TCU_APPS_SMMU_CB15_PMINTENCLR_APPS_ADDR A:0x61e1ff4c
y.create.l HWIO_TCU_APPS_SMMU_CB0_PMOVSCLR_APPS_ADDR A:0x61e10f50
y.create.l HWIO_TCU_APPS_SMMU_CB1_PMOVSCLR_APPS_ADDR A:0x61e11f50
y.create.l HWIO_TCU_APPS_SMMU_CB2_PMOVSCLR_APPS_ADDR A:0x61e12f50
y.create.l HWIO_TCU_APPS_SMMU_CB3_PMOVSCLR_APPS_ADDR A:0x61e13f50
y.create.l HWIO_TCU_APPS_SMMU_CB4_PMOVSCLR_APPS_ADDR A:0x61e14f50
y.create.l HWIO_TCU_APPS_SMMU_CB5_PMOVSCLR_APPS_ADDR A:0x61e15f50
y.create.l HWIO_TCU_APPS_SMMU_CB6_PMOVSCLR_APPS_ADDR A:0x61e16f50
y.create.l HWIO_TCU_APPS_SMMU_CB7_PMOVSCLR_APPS_ADDR A:0x61e17f50
y.create.l HWIO_TCU_APPS_SMMU_CB8_PMOVSCLR_APPS_ADDR A:0x61e18f50
y.create.l HWIO_TCU_APPS_SMMU_CB9_PMOVSCLR_APPS_ADDR A:0x61e19f50
y.create.l HWIO_TCU_APPS_SMMU_CB10_PMOVSCLR_APPS_ADDR A:0x61e1af50
y.create.l HWIO_TCU_APPS_SMMU_CB11_PMOVSCLR_APPS_ADDR A:0x61e1bf50
y.create.l HWIO_TCU_APPS_SMMU_CB12_PMOVSCLR_APPS_ADDR A:0x61e1cf50
y.create.l HWIO_TCU_APPS_SMMU_CB13_PMOVSCLR_APPS_ADDR A:0x61e1df50
y.create.l HWIO_TCU_APPS_SMMU_CB14_PMOVSCLR_APPS_ADDR A:0x61e1ef50
y.create.l HWIO_TCU_APPS_SMMU_CB15_PMOVSCLR_APPS_ADDR A:0x61e1ff50
y.create.l HWIO_TCU_APPS_SMMU_CB0_PMOVSSET_APPS_ADDR A:0x61e10f58
y.create.l HWIO_TCU_APPS_SMMU_CB1_PMOVSSET_APPS_ADDR A:0x61e11f58
y.create.l HWIO_TCU_APPS_SMMU_CB2_PMOVSSET_APPS_ADDR A:0x61e12f58
y.create.l HWIO_TCU_APPS_SMMU_CB3_PMOVSSET_APPS_ADDR A:0x61e13f58
y.create.l HWIO_TCU_APPS_SMMU_CB4_PMOVSSET_APPS_ADDR A:0x61e14f58
y.create.l HWIO_TCU_APPS_SMMU_CB5_PMOVSSET_APPS_ADDR A:0x61e15f58
y.create.l HWIO_TCU_APPS_SMMU_CB6_PMOVSSET_APPS_ADDR A:0x61e16f58
y.create.l HWIO_TCU_APPS_SMMU_CB7_PMOVSSET_APPS_ADDR A:0x61e17f58
y.create.l HWIO_TCU_APPS_SMMU_CB8_PMOVSSET_APPS_ADDR A:0x61e18f58
y.create.l HWIO_TCU_APPS_SMMU_CB9_PMOVSSET_APPS_ADDR A:0x61e19f58
y.create.l HWIO_TCU_APPS_SMMU_CB10_PMOVSSET_APPS_ADDR A:0x61e1af58
y.create.l HWIO_TCU_APPS_SMMU_CB11_PMOVSSET_APPS_ADDR A:0x61e1bf58
y.create.l HWIO_TCU_APPS_SMMU_CB12_PMOVSSET_APPS_ADDR A:0x61e1cf58
y.create.l HWIO_TCU_APPS_SMMU_CB13_PMOVSSET_APPS_ADDR A:0x61e1df58
y.create.l HWIO_TCU_APPS_SMMU_CB14_PMOVSSET_APPS_ADDR A:0x61e1ef58
y.create.l HWIO_TCU_APPS_SMMU_CB15_PMOVSSET_APPS_ADDR A:0x61e1ff58
y.create.l HWIO_TCU_APPS_SMMU_CB0_PMAUTHSTATUS_APPS_ADDR A:0x61e10fb8
y.create.l HWIO_TCU_APPS_SMMU_CB1_PMAUTHSTATUS_APPS_ADDR A:0x61e11fb8
y.create.l HWIO_TCU_APPS_SMMU_CB2_PMAUTHSTATUS_APPS_ADDR A:0x61e12fb8
y.create.l HWIO_TCU_APPS_SMMU_CB3_PMAUTHSTATUS_APPS_ADDR A:0x61e13fb8
y.create.l HWIO_TCU_APPS_SMMU_CB4_PMAUTHSTATUS_APPS_ADDR A:0x61e14fb8
y.create.l HWIO_TCU_APPS_SMMU_CB5_PMAUTHSTATUS_APPS_ADDR A:0x61e15fb8
y.create.l HWIO_TCU_APPS_SMMU_CB6_PMAUTHSTATUS_APPS_ADDR A:0x61e16fb8
y.create.l HWIO_TCU_APPS_SMMU_CB7_PMAUTHSTATUS_APPS_ADDR A:0x61e17fb8
y.create.l HWIO_TCU_APPS_SMMU_CB8_PMAUTHSTATUS_APPS_ADDR A:0x61e18fb8
y.create.l HWIO_TCU_APPS_SMMU_CB9_PMAUTHSTATUS_APPS_ADDR A:0x61e19fb8
y.create.l HWIO_TCU_APPS_SMMU_CB10_PMAUTHSTATUS_APPS_ADDR A:0x61e1afb8
y.create.l HWIO_TCU_APPS_SMMU_CB11_PMAUTHSTATUS_APPS_ADDR A:0x61e1bfb8
y.create.l HWIO_TCU_APPS_SMMU_CB12_PMAUTHSTATUS_APPS_ADDR A:0x61e1cfb8
y.create.l HWIO_TCU_APPS_SMMU_CB13_PMAUTHSTATUS_APPS_ADDR A:0x61e1dfb8
y.create.l HWIO_TCU_APPS_SMMU_CB14_PMAUTHSTATUS_APPS_ADDR A:0x61e1efb8
y.create.l HWIO_TCU_APPS_SMMU_CB15_PMAUTHSTATUS_APPS_ADDR A:0x61e1ffb8
y.create.l HWIO_TCU_APPS_SMMU_CR0_APPS_ADDR A:0x61e00000
y.create.l HWIO_TCU_APPS_SMMU_ACR_APPS_ADDR A:0x61e00010
y.create.l HWIO_TCU_APPS_SMMU_IDR0_APPS_ADDR A:0x61e00020
y.create.l HWIO_TCU_APPS_SMMU_IDR1_APPS_ADDR A:0x61e00024
y.create.l HWIO_TCU_APPS_SMMU_IDR2_APPS_ADDR A:0x61e00028
y.create.l HWIO_TCU_APPS_SMMU_IDR7_APPS_ADDR A:0x61e0003c
y.create.l HWIO_TCU_APPS_SMMU_GFAR_LOW_APPS_ADDR A:0x61e00040
y.create.l HWIO_TCU_APPS_SMMU_GFAR_HIGH_APPS_ADDR A:0x61e00044
y.create.l HWIO_TCU_APPS_SMMU_GFSR_APPS_ADDR A:0x61e00048
y.create.l HWIO_TCU_APPS_SMMU_GFSRRESTORE_APPS_ADDR A:0x61e0004c
y.create.l HWIO_TCU_APPS_SMMU_GFSYNR0_APPS_ADDR A:0x61e00050
y.create.l HWIO_TCU_APPS_SMMU_GFSYNR1_APPS_ADDR A:0x61e00054
y.create.l HWIO_TCU_APPS_SMMU_TLBIVMID_2_APPS_ADDR A:0x61e00064
y.create.l HWIO_TCU_APPS_SMMU_TLBIALLNSNH_2_APPS_ADDR A:0x61e00068
y.create.l HWIO_TCU_APPS_SMMU_TLBIALLH_APPS_ADDR A:0x61e0006c
y.create.l HWIO_TCU_APPS_SMMU_TLBGSYNC_APPS_ADDR A:0x61e00070
y.create.l HWIO_TCU_APPS_SMMU_TLBGSTATUS_APPS_ADDR A:0x61e00074
y.create.l HWIO_TCU_APPS_SMMU_TLBIVAH_LOW_APPS_ADDR A:0x61e00078
y.create.l HWIO_TCU_APPS_SMMU_TLBIVALH64_LOW_APPS_ADDR A:0x61e000b0
y.create.l HWIO_TCU_APPS_SMMU_TLBIVALH64_HIGH_APPS_ADDR A:0x61e000b4
y.create.l HWIO_TCU_APPS_SMMU_TLBIVMIDS1_APPS_ADDR A:0x61e000b8
y.create.l HWIO_TCU_APPS_SMMU_TLBIVAH64_LOW_APPS_ADDR A:0x61e000c0
y.create.l HWIO_TCU_APPS_SMMU_TLBIVAH64_HIGH_APPS_ADDR A:0x61e000c4
y.create.l HWIO_TCU_APPS_SMMU_SMR0_2_APPS_ADDR A:0x61e00800
y.create.l HWIO_TCU_APPS_SMMU_SMR1_2_APPS_ADDR A:0x61e00804
y.create.l HWIO_TCU_APPS_SMMU_SMR2_2_APPS_ADDR A:0x61e00808
y.create.l HWIO_TCU_APPS_SMMU_SMR3_2_APPS_ADDR A:0x61e0080c
y.create.l HWIO_TCU_APPS_SMMU_SMR4_2_APPS_ADDR A:0x61e00810
y.create.l HWIO_TCU_APPS_SMMU_SMR5_2_APPS_ADDR A:0x61e00814
y.create.l HWIO_TCU_APPS_SMMU_SMR6_2_APPS_ADDR A:0x61e00818
y.create.l HWIO_TCU_APPS_SMMU_SMR7_2_APPS_ADDR A:0x61e0081c
y.create.l HWIO_TCU_APPS_SMMU_SMR8_2_APPS_ADDR A:0x61e00820
y.create.l HWIO_TCU_APPS_SMMU_SMR9_2_APPS_ADDR A:0x61e00824
y.create.l HWIO_TCU_APPS_SMMU_SMR10_2_APPS_ADDR A:0x61e00828
y.create.l HWIO_TCU_APPS_SMMU_SMR11_2_APPS_ADDR A:0x61e0082c
y.create.l HWIO_TCU_APPS_SMMU_SMR12_2_APPS_ADDR A:0x61e00830
y.create.l HWIO_TCU_APPS_SMMU_SMR13_2_APPS_ADDR A:0x61e00834
y.create.l HWIO_TCU_APPS_SMMU_SMR14_2_APPS_ADDR A:0x61e00838
y.create.l HWIO_TCU_APPS_SMMU_SMR15_2_APPS_ADDR A:0x61e0083c
y.create.l HWIO_TCU_APPS_SMMU_SMR16_2_APPS_ADDR A:0x61e00840
y.create.l HWIO_TCU_APPS_SMMU_SMR17_2_APPS_ADDR A:0x61e00844
y.create.l HWIO_TCU_APPS_SMMU_SMR18_2_APPS_ADDR A:0x61e00848
y.create.l HWIO_TCU_APPS_SMMU_SMR19_2_APPS_ADDR A:0x61e0084c
y.create.l HWIO_TCU_APPS_SMMU_SMR20_2_APPS_ADDR A:0x61e00850
y.create.l HWIO_TCU_APPS_SMMU_SMR21_2_APPS_ADDR A:0x61e00854
y.create.l HWIO_TCU_APPS_SMMU_SMR22_2_APPS_ADDR A:0x61e00858
y.create.l HWIO_TCU_APPS_SMMU_SMR23_2_APPS_ADDR A:0x61e0085c
y.create.l HWIO_TCU_APPS_SMMU_SMR24_2_APPS_ADDR A:0x61e00860
y.create.l HWIO_TCU_APPS_SMMU_SMR25_2_APPS_ADDR A:0x61e00864
y.create.l HWIO_TCU_APPS_SMMU_SMR26_2_APPS_ADDR A:0x61e00868
y.create.l HWIO_TCU_APPS_SMMU_SMR27_2_APPS_ADDR A:0x61e0086c
y.create.l HWIO_TCU_APPS_SMMU_SMR28_2_APPS_ADDR A:0x61e00870
y.create.l HWIO_TCU_APPS_SMMU_SMR29_2_APPS_ADDR A:0x61e00874
y.create.l HWIO_TCU_APPS_SMMU_SMR30_2_APPS_ADDR A:0x61e00878
y.create.l HWIO_TCU_APPS_SMMU_SMR31_2_APPS_ADDR A:0x61e0087c
y.create.l HWIO_TCU_APPS_SMMU_S2CR0_2_APPS_ADDR A:0x61e00c00
y.create.l HWIO_TCU_APPS_SMMU_S2CR1_2_APPS_ADDR A:0x61e00c04
y.create.l HWIO_TCU_APPS_SMMU_S2CR2_2_APPS_ADDR A:0x61e00c08
y.create.l HWIO_TCU_APPS_SMMU_S2CR3_2_APPS_ADDR A:0x61e00c0c
y.create.l HWIO_TCU_APPS_SMMU_S2CR4_2_APPS_ADDR A:0x61e00c10
y.create.l HWIO_TCU_APPS_SMMU_S2CR5_2_APPS_ADDR A:0x61e00c14
y.create.l HWIO_TCU_APPS_SMMU_S2CR6_2_APPS_ADDR A:0x61e00c18
y.create.l HWIO_TCU_APPS_SMMU_S2CR7_2_APPS_ADDR A:0x61e00c1c
y.create.l HWIO_TCU_APPS_SMMU_S2CR8_2_APPS_ADDR A:0x61e00c20
y.create.l HWIO_TCU_APPS_SMMU_S2CR9_2_APPS_ADDR A:0x61e00c24
y.create.l HWIO_TCU_APPS_SMMU_S2CR10_2_APPS_ADDR A:0x61e00c28
y.create.l HWIO_TCU_APPS_SMMU_S2CR11_2_APPS_ADDR A:0x61e00c2c
y.create.l HWIO_TCU_APPS_SMMU_S2CR12_2_APPS_ADDR A:0x61e00c30
y.create.l HWIO_TCU_APPS_SMMU_S2CR13_2_APPS_ADDR A:0x61e00c34
y.create.l HWIO_TCU_APPS_SMMU_S2CR14_2_APPS_ADDR A:0x61e00c38
y.create.l HWIO_TCU_APPS_SMMU_S2CR15_2_APPS_ADDR A:0x61e00c3c
y.create.l HWIO_TCU_APPS_SMMU_S2CR16_2_APPS_ADDR A:0x61e00c40
y.create.l HWIO_TCU_APPS_SMMU_S2CR17_2_APPS_ADDR A:0x61e00c44
y.create.l HWIO_TCU_APPS_SMMU_S2CR18_2_APPS_ADDR A:0x61e00c48
y.create.l HWIO_TCU_APPS_SMMU_S2CR19_2_APPS_ADDR A:0x61e00c4c
y.create.l HWIO_TCU_APPS_SMMU_S2CR20_2_APPS_ADDR A:0x61e00c50
y.create.l HWIO_TCU_APPS_SMMU_S2CR21_2_APPS_ADDR A:0x61e00c54
y.create.l HWIO_TCU_APPS_SMMU_S2CR22_2_APPS_ADDR A:0x61e00c58
y.create.l HWIO_TCU_APPS_SMMU_S2CR23_2_APPS_ADDR A:0x61e00c5c
y.create.l HWIO_TCU_APPS_SMMU_S2CR24_2_APPS_ADDR A:0x61e00c60
y.create.l HWIO_TCU_APPS_SMMU_S2CR25_2_APPS_ADDR A:0x61e00c64
y.create.l HWIO_TCU_APPS_SMMU_S2CR26_2_APPS_ADDR A:0x61e00c68
y.create.l HWIO_TCU_APPS_SMMU_S2CR27_2_APPS_ADDR A:0x61e00c6c
y.create.l HWIO_TCU_APPS_SMMU_S2CR28_2_APPS_ADDR A:0x61e00c70
y.create.l HWIO_TCU_APPS_SMMU_S2CR29_2_APPS_ADDR A:0x61e00c74
y.create.l HWIO_TCU_APPS_SMMU_S2CR30_2_APPS_ADDR A:0x61e00c78
y.create.l HWIO_TCU_APPS_SMMU_S2CR31_2_APPS_ADDR A:0x61e00c7c
y.create.l HWIO_TCU_APPS_SMMU_PIDR0_2_APPS_ADDR A:0x61e00fe0
y.create.l HWIO_TCU_APPS_SMMU_PIDR1_2_APPS_ADDR A:0x61e00fe4
y.create.l HWIO_TCU_APPS_SMMU_PIDR2_2_APPS_ADDR A:0x61e00fe8
y.create.l HWIO_TCU_APPS_SMMU_PIDR3_2_APPS_ADDR A:0x61e00fec
y.create.l HWIO_TCU_APPS_SMMU_PIDR4_2_APPS_ADDR A:0x61e00fd0
y.create.l HWIO_TCU_APPS_SMMU_PIDR5_2_APPS_ADDR A:0x61e00fd4
y.create.l HWIO_TCU_APPS_SMMU_PIDR6_2_APPS_ADDR A:0x61e00fd8
y.create.l HWIO_TCU_APPS_SMMU_PIDR7_2_APPS_ADDR A:0x61e00fdc
y.create.l HWIO_TCU_APPS_SMMU_CIDR0_2_APPS_ADDR A:0x61e00ff0
y.create.l HWIO_TCU_APPS_SMMU_CIDR1_2_APPS_ADDR A:0x61e00ff4
y.create.l HWIO_TCU_APPS_SMMU_CIDR2_2_APPS_ADDR A:0x61e00ff8
y.create.l HWIO_TCU_APPS_SMMU_CIDR3_2_APPS_ADDR A:0x61e00ffc
y.create.l HWIO_TCU_APPS_SMMU_CBAR0_2_APPS_ADDR A:0x61e01000
y.create.l HWIO_TCU_APPS_SMMU_CBFRSYNRA0_2_APPS_ADDR A:0x61e01400
y.create.l HWIO_TCU_APPS_SMMU_CBA2R0_2_APPS_ADDR A:0x61e01800
y.create.l HWIO_TCU_APPS_SMMU_CBAR1_2_APPS_ADDR A:0x61e01004
y.create.l HWIO_TCU_APPS_SMMU_CBFRSYNRA1_2_APPS_ADDR A:0x61e01404
y.create.l HWIO_TCU_APPS_SMMU_CBA2R1_2_APPS_ADDR A:0x61e01804
y.create.l HWIO_TCU_APPS_SMMU_CBAR2_2_APPS_ADDR A:0x61e01008
y.create.l HWIO_TCU_APPS_SMMU_CBFRSYNRA2_2_APPS_ADDR A:0x61e01408
y.create.l HWIO_TCU_APPS_SMMU_CBA2R2_2_APPS_ADDR A:0x61e01808
y.create.l HWIO_TCU_APPS_SMMU_CBAR3_2_APPS_ADDR A:0x61e0100c
y.create.l HWIO_TCU_APPS_SMMU_CBFRSYNRA3_2_APPS_ADDR A:0x61e0140c
y.create.l HWIO_TCU_APPS_SMMU_CBA2R3_2_APPS_ADDR A:0x61e0180c
y.create.l HWIO_TCU_APPS_SMMU_CBAR4_2_APPS_ADDR A:0x61e01010
y.create.l HWIO_TCU_APPS_SMMU_CBFRSYNRA4_2_APPS_ADDR A:0x61e01410
y.create.l HWIO_TCU_APPS_SMMU_CBA2R4_2_APPS_ADDR A:0x61e01810
y.create.l HWIO_TCU_APPS_SMMU_CBAR5_2_APPS_ADDR A:0x61e01014
y.create.l HWIO_TCU_APPS_SMMU_CBFRSYNRA5_2_APPS_ADDR A:0x61e01414
y.create.l HWIO_TCU_APPS_SMMU_CBA2R5_2_APPS_ADDR A:0x61e01814
y.create.l HWIO_TCU_APPS_SMMU_CBAR6_2_APPS_ADDR A:0x61e01018
y.create.l HWIO_TCU_APPS_SMMU_CBFRSYNRA6_2_APPS_ADDR A:0x61e01418
y.create.l HWIO_TCU_APPS_SMMU_CBA2R6_2_APPS_ADDR A:0x61e01818
y.create.l HWIO_TCU_APPS_SMMU_CBAR7_2_APPS_ADDR A:0x61e0101c
y.create.l HWIO_TCU_APPS_SMMU_CBFRSYNRA7_2_APPS_ADDR A:0x61e0141c
y.create.l HWIO_TCU_APPS_SMMU_CBA2R7_2_APPS_ADDR A:0x61e0181c
y.create.l HWIO_TCU_APPS_SMMU_CBAR8_2_APPS_ADDR A:0x61e01020
y.create.l HWIO_TCU_APPS_SMMU_CBFRSYNRA8_2_APPS_ADDR A:0x61e01420
y.create.l HWIO_TCU_APPS_SMMU_CBA2R8_2_APPS_ADDR A:0x61e01820
y.create.l HWIO_TCU_APPS_SMMU_CBAR9_2_APPS_ADDR A:0x61e01024
y.create.l HWIO_TCU_APPS_SMMU_CBFRSYNRA9_2_APPS_ADDR A:0x61e01424
y.create.l HWIO_TCU_APPS_SMMU_CBA2R9_2_APPS_ADDR A:0x61e01824
y.create.l HWIO_TCU_APPS_SMMU_CBAR10_2_APPS_ADDR A:0x61e01028
y.create.l HWIO_TCU_APPS_SMMU_CBFRSYNRA10_2_APPS_ADDR A:0x61e01428
y.create.l HWIO_TCU_APPS_SMMU_CBA2R10_2_APPS_ADDR A:0x61e01828
y.create.l HWIO_TCU_APPS_SMMU_CBAR11_2_APPS_ADDR A:0x61e0102c
y.create.l HWIO_TCU_APPS_SMMU_CBFRSYNRA11_2_APPS_ADDR A:0x61e0142c
y.create.l HWIO_TCU_APPS_SMMU_CBA2R11_2_APPS_ADDR A:0x61e0182c
y.create.l HWIO_TCU_APPS_SMMU_CBAR12_2_APPS_ADDR A:0x61e01030
y.create.l HWIO_TCU_APPS_SMMU_CBFRSYNRA12_2_APPS_ADDR A:0x61e01430
y.create.l HWIO_TCU_APPS_SMMU_CBA2R12_2_APPS_ADDR A:0x61e01830
y.create.l HWIO_TCU_APPS_SMMU_CBAR13_2_APPS_ADDR A:0x61e01034
y.create.l HWIO_TCU_APPS_SMMU_CBFRSYNRA13_2_APPS_ADDR A:0x61e01434
y.create.l HWIO_TCU_APPS_SMMU_CBA2R13_2_APPS_ADDR A:0x61e01834
y.create.l HWIO_TCU_APPS_SMMU_CBAR14_2_APPS_ADDR A:0x61e01038
y.create.l HWIO_TCU_APPS_SMMU_CBFRSYNRA14_2_APPS_ADDR A:0x61e01438
y.create.l HWIO_TCU_APPS_SMMU_CBA2R14_2_APPS_ADDR A:0x61e01838
y.create.l HWIO_TCU_APPS_SMMU_CBAR15_2_APPS_ADDR A:0x61e0103c
y.create.l HWIO_TCU_APPS_SMMU_CBFRSYNRA15_2_APPS_ADDR A:0x61e0143c
y.create.l HWIO_TCU_APPS_SMMU_CBA2R15_2_APPS_ADDR A:0x61e0183c
y.create.l HWIO_TCU_APPS_PMEVCNTR0_2_APPS_ADDR A:0x61e03000
y.create.l HWIO_TCU_APPS_PMEVCNTR1_2_APPS_ADDR A:0x61e03004
y.create.l HWIO_TCU_APPS_PMEVCNTR2_2_APPS_ADDR A:0x61e03008
y.create.l HWIO_TCU_APPS_PMEVCNTR3_2_APPS_ADDR A:0x61e0300c
y.create.l HWIO_TCU_APPS_PMEVTYPER0_2_APPS_ADDR A:0x61e03400
y.create.l HWIO_TCU_APPS_PMEVTYPER1_2_APPS_ADDR A:0x61e03404
y.create.l HWIO_TCU_APPS_PMEVTYPER2_2_APPS_ADDR A:0x61e03408
y.create.l HWIO_TCU_APPS_PMEVTYPER3_2_APPS_ADDR A:0x61e0340c
y.create.l HWIO_TCU_APPS_PMCGCR_2_APPS_ADDR A:0x61e03800
y.create.l HWIO_TCU_APPS_PMCGSMR_2_APPS_ADDR A:0x61e03a00
y.create.l HWIO_TCU_APPS_PMCNTENSET_2_APPS_ADDR A:0x61e03c00
y.create.l HWIO_TCU_APPS_PMCNTENCLR_2_APPS_ADDR A:0x61e03c20
y.create.l HWIO_TCU_APPS_PMINTENSET_2_APPS_ADDR A:0x61e03c40
y.create.l HWIO_TCU_APPS_PMINTENCLR_2_APPS_ADDR A:0x61e03c60
y.create.l HWIO_TCU_APPS_PMOVSCLR_2_APPS_ADDR A:0x61e03c80
y.create.l HWIO_TCU_APPS_PMOVSSET_2_APPS_ADDR A:0x61e03cc0
y.create.l HWIO_TCU_APPS_PMCFGR_2_APPS_ADDR A:0x61e03e00
y.create.l HWIO_TCU_APPS_PMCR_2_APPS_ADDR A:0x61e03e04
y.create.l HWIO_TCU_APPS_SMMU_PMCEID0_2_APPS_ADDR A:0x61e03e20
y.create.l HWIO_TCU_APPS_SMMU_PMAUTHSTATUS_2_APPS_ADDR A:0x61e03fb8
y.create.l HWIO_TCU_APPS_SMMU_PMDEVTYPE_2_APPS_ADDR A:0x61e03fcc
y.create.l HWIO_TCU_APPS_SMMU_CB0_SCTLR_2_APPS_ADDR A:0x61e10000
y.create.l HWIO_TCU_APPS_SMMU_CB1_SCTLR_2_APPS_ADDR A:0x61e11000
y.create.l HWIO_TCU_APPS_SMMU_CB2_SCTLR_2_APPS_ADDR A:0x61e12000
y.create.l HWIO_TCU_APPS_SMMU_CB3_SCTLR_2_APPS_ADDR A:0x61e13000
y.create.l HWIO_TCU_APPS_SMMU_CB4_SCTLR_2_APPS_ADDR A:0x61e14000
y.create.l HWIO_TCU_APPS_SMMU_CB5_SCTLR_2_APPS_ADDR A:0x61e15000
y.create.l HWIO_TCU_APPS_SMMU_CB6_SCTLR_2_APPS_ADDR A:0x61e16000
y.create.l HWIO_TCU_APPS_SMMU_CB7_SCTLR_2_APPS_ADDR A:0x61e17000
y.create.l HWIO_TCU_APPS_SMMU_CB8_SCTLR_2_APPS_ADDR A:0x61e18000
y.create.l HWIO_TCU_APPS_SMMU_CB9_SCTLR_2_APPS_ADDR A:0x61e19000
y.create.l HWIO_TCU_APPS_SMMU_CB10_SCTLR_2_APPS_ADDR A:0x61e1a000
y.create.l HWIO_TCU_APPS_SMMU_CB11_SCTLR_2_APPS_ADDR A:0x61e1b000
y.create.l HWIO_TCU_APPS_SMMU_CB12_SCTLR_2_APPS_ADDR A:0x61e1c000
y.create.l HWIO_TCU_APPS_SMMU_CB13_SCTLR_2_APPS_ADDR A:0x61e1d000
y.create.l HWIO_TCU_APPS_SMMU_CB14_SCTLR_2_APPS_ADDR A:0x61e1e000
y.create.l HWIO_TCU_APPS_SMMU_CB15_SCTLR_2_APPS_ADDR A:0x61e1f000
y.create.l HWIO_TCU_APPS_SMMU_CB0_ACTLR_2_APPS_ADDR A:0x61e10004
y.create.l HWIO_TCU_APPS_SMMU_CB1_ACTLR_2_APPS_ADDR A:0x61e11004
y.create.l HWIO_TCU_APPS_SMMU_CB2_ACTLR_2_APPS_ADDR A:0x61e12004
y.create.l HWIO_TCU_APPS_SMMU_CB3_ACTLR_2_APPS_ADDR A:0x61e13004
y.create.l HWIO_TCU_APPS_SMMU_CB4_ACTLR_2_APPS_ADDR A:0x61e14004
y.create.l HWIO_TCU_APPS_SMMU_CB5_ACTLR_2_APPS_ADDR A:0x61e15004
y.create.l HWIO_TCU_APPS_SMMU_CB6_ACTLR_2_APPS_ADDR A:0x61e16004
y.create.l HWIO_TCU_APPS_SMMU_CB7_ACTLR_2_APPS_ADDR A:0x61e17004
y.create.l HWIO_TCU_APPS_SMMU_CB8_ACTLR_2_APPS_ADDR A:0x61e18004
y.create.l HWIO_TCU_APPS_SMMU_CB9_ACTLR_2_APPS_ADDR A:0x61e19004
y.create.l HWIO_TCU_APPS_SMMU_CB10_ACTLR_2_APPS_ADDR A:0x61e1a004
y.create.l HWIO_TCU_APPS_SMMU_CB11_ACTLR_2_APPS_ADDR A:0x61e1b004
y.create.l HWIO_TCU_APPS_SMMU_CB12_ACTLR_2_APPS_ADDR A:0x61e1c004
y.create.l HWIO_TCU_APPS_SMMU_CB13_ACTLR_2_APPS_ADDR A:0x61e1d004
y.create.l HWIO_TCU_APPS_SMMU_CB14_ACTLR_2_APPS_ADDR A:0x61e1e004
y.create.l HWIO_TCU_APPS_SMMU_CB15_ACTLR_2_APPS_ADDR A:0x61e1f004
y.create.l HWIO_TCU_APPS_SMMU_CB0_RESUME_2_APPS_ADDR A:0x61e10008
y.create.l HWIO_TCU_APPS_SMMU_CB1_RESUME_2_APPS_ADDR A:0x61e11008
y.create.l HWIO_TCU_APPS_SMMU_CB2_RESUME_2_APPS_ADDR A:0x61e12008
y.create.l HWIO_TCU_APPS_SMMU_CB3_RESUME_2_APPS_ADDR A:0x61e13008
y.create.l HWIO_TCU_APPS_SMMU_CB4_RESUME_2_APPS_ADDR A:0x61e14008
y.create.l HWIO_TCU_APPS_SMMU_CB5_RESUME_2_APPS_ADDR A:0x61e15008
y.create.l HWIO_TCU_APPS_SMMU_CB6_RESUME_2_APPS_ADDR A:0x61e16008
y.create.l HWIO_TCU_APPS_SMMU_CB7_RESUME_2_APPS_ADDR A:0x61e17008
y.create.l HWIO_TCU_APPS_SMMU_CB8_RESUME_2_APPS_ADDR A:0x61e18008
y.create.l HWIO_TCU_APPS_SMMU_CB9_RESUME_2_APPS_ADDR A:0x61e19008
y.create.l HWIO_TCU_APPS_SMMU_CB10_RESUME_2_APPS_ADDR A:0x61e1a008
y.create.l HWIO_TCU_APPS_SMMU_CB11_RESUME_2_APPS_ADDR A:0x61e1b008
y.create.l HWIO_TCU_APPS_SMMU_CB12_RESUME_2_APPS_ADDR A:0x61e1c008
y.create.l HWIO_TCU_APPS_SMMU_CB13_RESUME_2_APPS_ADDR A:0x61e1d008
y.create.l HWIO_TCU_APPS_SMMU_CB14_RESUME_2_APPS_ADDR A:0x61e1e008
y.create.l HWIO_TCU_APPS_SMMU_CB15_RESUME_2_APPS_ADDR A:0x61e1f008
y.create.l HWIO_TCU_APPS_SMMU_CB0_TTBCR2_2_APPS_ADDR A:0x61e10010
y.create.l HWIO_TCU_APPS_SMMU_CB1_TTBCR2_2_APPS_ADDR A:0x61e11010
y.create.l HWIO_TCU_APPS_SMMU_CB2_TTBCR2_2_APPS_ADDR A:0x61e12010
y.create.l HWIO_TCU_APPS_SMMU_CB3_TTBCR2_2_APPS_ADDR A:0x61e13010
y.create.l HWIO_TCU_APPS_SMMU_CB4_TTBCR2_2_APPS_ADDR A:0x61e14010
y.create.l HWIO_TCU_APPS_SMMU_CB5_TTBCR2_2_APPS_ADDR A:0x61e15010
y.create.l HWIO_TCU_APPS_SMMU_CB6_TTBCR2_2_APPS_ADDR A:0x61e16010
y.create.l HWIO_TCU_APPS_SMMU_CB7_TTBCR2_2_APPS_ADDR A:0x61e17010
y.create.l HWIO_TCU_APPS_SMMU_CB8_TTBCR2_2_APPS_ADDR A:0x61e18010
y.create.l HWIO_TCU_APPS_SMMU_CB9_TTBCR2_2_APPS_ADDR A:0x61e19010
y.create.l HWIO_TCU_APPS_SMMU_CB10_TTBCR2_2_APPS_ADDR A:0x61e1a010
y.create.l HWIO_TCU_APPS_SMMU_CB11_TTBCR2_2_APPS_ADDR A:0x61e1b010
y.create.l HWIO_TCU_APPS_SMMU_CB12_TTBCR2_2_APPS_ADDR A:0x61e1c010
y.create.l HWIO_TCU_APPS_SMMU_CB13_TTBCR2_2_APPS_ADDR A:0x61e1d010
y.create.l HWIO_TCU_APPS_SMMU_CB14_TTBCR2_2_APPS_ADDR A:0x61e1e010
y.create.l HWIO_TCU_APPS_SMMU_CB15_TTBCR2_2_APPS_ADDR A:0x61e1f010
y.create.l HWIO_TCU_APPS_SMMU_CB0_TTBR0_LOW_2_APPS_ADDR A:0x61e10020
y.create.l HWIO_TCU_APPS_SMMU_CB1_TTBR0_LOW_2_APPS_ADDR A:0x61e11020
y.create.l HWIO_TCU_APPS_SMMU_CB2_TTBR0_LOW_2_APPS_ADDR A:0x61e12020
y.create.l HWIO_TCU_APPS_SMMU_CB3_TTBR0_LOW_2_APPS_ADDR A:0x61e13020
y.create.l HWIO_TCU_APPS_SMMU_CB4_TTBR0_LOW_2_APPS_ADDR A:0x61e14020
y.create.l HWIO_TCU_APPS_SMMU_CB5_TTBR0_LOW_2_APPS_ADDR A:0x61e15020
y.create.l HWIO_TCU_APPS_SMMU_CB6_TTBR0_LOW_2_APPS_ADDR A:0x61e16020
y.create.l HWIO_TCU_APPS_SMMU_CB7_TTBR0_LOW_2_APPS_ADDR A:0x61e17020
y.create.l HWIO_TCU_APPS_SMMU_CB8_TTBR0_LOW_2_APPS_ADDR A:0x61e18020
y.create.l HWIO_TCU_APPS_SMMU_CB9_TTBR0_LOW_2_APPS_ADDR A:0x61e19020
y.create.l HWIO_TCU_APPS_SMMU_CB10_TTBR0_LOW_2_APPS_ADDR A:0x61e1a020
y.create.l HWIO_TCU_APPS_SMMU_CB11_TTBR0_LOW_2_APPS_ADDR A:0x61e1b020
y.create.l HWIO_TCU_APPS_SMMU_CB12_TTBR0_LOW_2_APPS_ADDR A:0x61e1c020
y.create.l HWIO_TCU_APPS_SMMU_CB13_TTBR0_LOW_2_APPS_ADDR A:0x61e1d020
y.create.l HWIO_TCU_APPS_SMMU_CB14_TTBR0_LOW_2_APPS_ADDR A:0x61e1e020
y.create.l HWIO_TCU_APPS_SMMU_CB15_TTBR0_LOW_2_APPS_ADDR A:0x61e1f020
y.create.l HWIO_TCU_APPS_SMMU_CB0_TTBR0_HIGH_2_APPS_ADDR A:0x61e10024
y.create.l HWIO_TCU_APPS_SMMU_CB1_TTBR0_HIGH_2_APPS_ADDR A:0x61e11024
y.create.l HWIO_TCU_APPS_SMMU_CB2_TTBR0_HIGH_2_APPS_ADDR A:0x61e12024
y.create.l HWIO_TCU_APPS_SMMU_CB3_TTBR0_HIGH_2_APPS_ADDR A:0x61e13024
y.create.l HWIO_TCU_APPS_SMMU_CB4_TTBR0_HIGH_2_APPS_ADDR A:0x61e14024
y.create.l HWIO_TCU_APPS_SMMU_CB5_TTBR0_HIGH_2_APPS_ADDR A:0x61e15024
y.create.l HWIO_TCU_APPS_SMMU_CB6_TTBR0_HIGH_2_APPS_ADDR A:0x61e16024
y.create.l HWIO_TCU_APPS_SMMU_CB7_TTBR0_HIGH_2_APPS_ADDR A:0x61e17024
y.create.l HWIO_TCU_APPS_SMMU_CB8_TTBR0_HIGH_2_APPS_ADDR A:0x61e18024
y.create.l HWIO_TCU_APPS_SMMU_CB9_TTBR0_HIGH_2_APPS_ADDR A:0x61e19024
y.create.l HWIO_TCU_APPS_SMMU_CB10_TTBR0_HIGH_2_APPS_ADDR A:0x61e1a024
y.create.l HWIO_TCU_APPS_SMMU_CB11_TTBR0_HIGH_2_APPS_ADDR A:0x61e1b024
y.create.l HWIO_TCU_APPS_SMMU_CB12_TTBR0_HIGH_2_APPS_ADDR A:0x61e1c024
y.create.l HWIO_TCU_APPS_SMMU_CB13_TTBR0_HIGH_2_APPS_ADDR A:0x61e1d024
y.create.l HWIO_TCU_APPS_SMMU_CB14_TTBR0_HIGH_2_APPS_ADDR A:0x61e1e024
y.create.l HWIO_TCU_APPS_SMMU_CB15_TTBR0_HIGH_2_APPS_ADDR A:0x61e1f024
y.create.l HWIO_TCU_APPS_SMMU_CB0_TTBR1_LOW_2_APPS_ADDR A:0x61e10028
y.create.l HWIO_TCU_APPS_SMMU_CB1_TTBR1_LOW_2_APPS_ADDR A:0x61e11028
y.create.l HWIO_TCU_APPS_SMMU_CB2_TTBR1_LOW_2_APPS_ADDR A:0x61e12028
y.create.l HWIO_TCU_APPS_SMMU_CB3_TTBR1_LOW_2_APPS_ADDR A:0x61e13028
y.create.l HWIO_TCU_APPS_SMMU_CB4_TTBR1_LOW_2_APPS_ADDR A:0x61e14028
y.create.l HWIO_TCU_APPS_SMMU_CB5_TTBR1_LOW_2_APPS_ADDR A:0x61e15028
y.create.l HWIO_TCU_APPS_SMMU_CB6_TTBR1_LOW_2_APPS_ADDR A:0x61e16028
y.create.l HWIO_TCU_APPS_SMMU_CB7_TTBR1_LOW_2_APPS_ADDR A:0x61e17028
y.create.l HWIO_TCU_APPS_SMMU_CB8_TTBR1_LOW_2_APPS_ADDR A:0x61e18028
y.create.l HWIO_TCU_APPS_SMMU_CB9_TTBR1_LOW_2_APPS_ADDR A:0x61e19028
y.create.l HWIO_TCU_APPS_SMMU_CB10_TTBR1_LOW_2_APPS_ADDR A:0x61e1a028
y.create.l HWIO_TCU_APPS_SMMU_CB11_TTBR1_LOW_2_APPS_ADDR A:0x61e1b028
y.create.l HWIO_TCU_APPS_SMMU_CB12_TTBR1_LOW_2_APPS_ADDR A:0x61e1c028
y.create.l HWIO_TCU_APPS_SMMU_CB13_TTBR1_LOW_2_APPS_ADDR A:0x61e1d028
y.create.l HWIO_TCU_APPS_SMMU_CB14_TTBR1_LOW_2_APPS_ADDR A:0x61e1e028
y.create.l HWIO_TCU_APPS_SMMU_CB15_TTBR1_LOW_2_APPS_ADDR A:0x61e1f028
y.create.l HWIO_TCU_APPS_SMMU_CB0_TTBR1_HIGH_2_APPS_ADDR A:0x61e1002c
y.create.l HWIO_TCU_APPS_SMMU_CB1_TTBR1_HIGH_2_APPS_ADDR A:0x61e1102c
y.create.l HWIO_TCU_APPS_SMMU_CB2_TTBR1_HIGH_2_APPS_ADDR A:0x61e1202c
y.create.l HWIO_TCU_APPS_SMMU_CB3_TTBR1_HIGH_2_APPS_ADDR A:0x61e1302c
y.create.l HWIO_TCU_APPS_SMMU_CB4_TTBR1_HIGH_2_APPS_ADDR A:0x61e1402c
y.create.l HWIO_TCU_APPS_SMMU_CB5_TTBR1_HIGH_2_APPS_ADDR A:0x61e1502c
y.create.l HWIO_TCU_APPS_SMMU_CB6_TTBR1_HIGH_2_APPS_ADDR A:0x61e1602c
y.create.l HWIO_TCU_APPS_SMMU_CB7_TTBR1_HIGH_2_APPS_ADDR A:0x61e1702c
y.create.l HWIO_TCU_APPS_SMMU_CB8_TTBR1_HIGH_2_APPS_ADDR A:0x61e1802c
y.create.l HWIO_TCU_APPS_SMMU_CB9_TTBR1_HIGH_2_APPS_ADDR A:0x61e1902c
y.create.l HWIO_TCU_APPS_SMMU_CB10_TTBR1_HIGH_2_APPS_ADDR A:0x61e1a02c
y.create.l HWIO_TCU_APPS_SMMU_CB11_TTBR1_HIGH_2_APPS_ADDR A:0x61e1b02c
y.create.l HWIO_TCU_APPS_SMMU_CB12_TTBR1_HIGH_2_APPS_ADDR A:0x61e1c02c
y.create.l HWIO_TCU_APPS_SMMU_CB13_TTBR1_HIGH_2_APPS_ADDR A:0x61e1d02c
y.create.l HWIO_TCU_APPS_SMMU_CB14_TTBR1_HIGH_2_APPS_ADDR A:0x61e1e02c
y.create.l HWIO_TCU_APPS_SMMU_CB15_TTBR1_HIGH_2_APPS_ADDR A:0x61e1f02c
y.create.l HWIO_TCU_APPS_SMMU_CB0_TTBCR_LPAE_2_APPS_ADDR A:0x61e10030
y.create.l HWIO_TCU_APPS_SMMU_CB1_TTBCR_LPAE_2_APPS_ADDR A:0x61e11030
y.create.l HWIO_TCU_APPS_SMMU_CB2_TTBCR_LPAE_2_APPS_ADDR A:0x61e12030
y.create.l HWIO_TCU_APPS_SMMU_CB3_TTBCR_LPAE_2_APPS_ADDR A:0x61e13030
y.create.l HWIO_TCU_APPS_SMMU_CB4_TTBCR_LPAE_2_APPS_ADDR A:0x61e14030
y.create.l HWIO_TCU_APPS_SMMU_CB5_TTBCR_LPAE_2_APPS_ADDR A:0x61e15030
y.create.l HWIO_TCU_APPS_SMMU_CB6_TTBCR_LPAE_2_APPS_ADDR A:0x61e16030
y.create.l HWIO_TCU_APPS_SMMU_CB7_TTBCR_LPAE_2_APPS_ADDR A:0x61e17030
y.create.l HWIO_TCU_APPS_SMMU_CB8_TTBCR_LPAE_2_APPS_ADDR A:0x61e18030
y.create.l HWIO_TCU_APPS_SMMU_CB9_TTBCR_LPAE_2_APPS_ADDR A:0x61e19030
y.create.l HWIO_TCU_APPS_SMMU_CB10_TTBCR_LPAE_2_APPS_ADDR A:0x61e1a030
y.create.l HWIO_TCU_APPS_SMMU_CB11_TTBCR_LPAE_2_APPS_ADDR A:0x61e1b030
y.create.l HWIO_TCU_APPS_SMMU_CB12_TTBCR_LPAE_2_APPS_ADDR A:0x61e1c030
y.create.l HWIO_TCU_APPS_SMMU_CB13_TTBCR_LPAE_2_APPS_ADDR A:0x61e1d030
y.create.l HWIO_TCU_APPS_SMMU_CB14_TTBCR_LPAE_2_APPS_ADDR A:0x61e1e030
y.create.l HWIO_TCU_APPS_SMMU_CB15_TTBCR_LPAE_2_APPS_ADDR A:0x61e1f030
y.create.l HWIO_TCU_APPS_SMMU_CB0_CONTEXTIDR_2_APPS_ADDR A:0x61e10034
y.create.l HWIO_TCU_APPS_SMMU_CB1_CONTEXTIDR_2_APPS_ADDR A:0x61e11034
y.create.l HWIO_TCU_APPS_SMMU_CB2_CONTEXTIDR_2_APPS_ADDR A:0x61e12034
y.create.l HWIO_TCU_APPS_SMMU_CB3_CONTEXTIDR_2_APPS_ADDR A:0x61e13034
y.create.l HWIO_TCU_APPS_SMMU_CB4_CONTEXTIDR_2_APPS_ADDR A:0x61e14034
y.create.l HWIO_TCU_APPS_SMMU_CB5_CONTEXTIDR_2_APPS_ADDR A:0x61e15034
y.create.l HWIO_TCU_APPS_SMMU_CB6_CONTEXTIDR_2_APPS_ADDR A:0x61e16034
y.create.l HWIO_TCU_APPS_SMMU_CB7_CONTEXTIDR_2_APPS_ADDR A:0x61e17034
y.create.l HWIO_TCU_APPS_SMMU_CB8_CONTEXTIDR_2_APPS_ADDR A:0x61e18034
y.create.l HWIO_TCU_APPS_SMMU_CB9_CONTEXTIDR_2_APPS_ADDR A:0x61e19034
y.create.l HWIO_TCU_APPS_SMMU_CB10_CONTEXTIDR_2_APPS_ADDR A:0x61e1a034
y.create.l HWIO_TCU_APPS_SMMU_CB11_CONTEXTIDR_2_APPS_ADDR A:0x61e1b034
y.create.l HWIO_TCU_APPS_SMMU_CB12_CONTEXTIDR_2_APPS_ADDR A:0x61e1c034
y.create.l HWIO_TCU_APPS_SMMU_CB13_CONTEXTIDR_2_APPS_ADDR A:0x61e1d034
y.create.l HWIO_TCU_APPS_SMMU_CB14_CONTEXTIDR_2_APPS_ADDR A:0x61e1e034
y.create.l HWIO_TCU_APPS_SMMU_CB15_CONTEXTIDR_2_APPS_ADDR A:0x61e1f034
y.create.l HWIO_TCU_APPS_SMMU_CB0_PRRR_MAIR0_2_APPS_ADDR A:0x61e10038
y.create.l HWIO_TCU_APPS_SMMU_CB1_PRRR_MAIR0_2_APPS_ADDR A:0x61e11038
y.create.l HWIO_TCU_APPS_SMMU_CB2_PRRR_MAIR0_2_APPS_ADDR A:0x61e12038
y.create.l HWIO_TCU_APPS_SMMU_CB3_PRRR_MAIR0_2_APPS_ADDR A:0x61e13038
y.create.l HWIO_TCU_APPS_SMMU_CB4_PRRR_MAIR0_2_APPS_ADDR A:0x61e14038
y.create.l HWIO_TCU_APPS_SMMU_CB5_PRRR_MAIR0_2_APPS_ADDR A:0x61e15038
y.create.l HWIO_TCU_APPS_SMMU_CB6_PRRR_MAIR0_2_APPS_ADDR A:0x61e16038
y.create.l HWIO_TCU_APPS_SMMU_CB7_PRRR_MAIR0_2_APPS_ADDR A:0x61e17038
y.create.l HWIO_TCU_APPS_SMMU_CB8_PRRR_MAIR0_2_APPS_ADDR A:0x61e18038
y.create.l HWIO_TCU_APPS_SMMU_CB9_PRRR_MAIR0_2_APPS_ADDR A:0x61e19038
y.create.l HWIO_TCU_APPS_SMMU_CB10_PRRR_MAIR0_2_APPS_ADDR A:0x61e1a038
y.create.l HWIO_TCU_APPS_SMMU_CB11_PRRR_MAIR0_2_APPS_ADDR A:0x61e1b038
y.create.l HWIO_TCU_APPS_SMMU_CB12_PRRR_MAIR0_2_APPS_ADDR A:0x61e1c038
y.create.l HWIO_TCU_APPS_SMMU_CB13_PRRR_MAIR0_2_APPS_ADDR A:0x61e1d038
y.create.l HWIO_TCU_APPS_SMMU_CB14_PRRR_MAIR0_2_APPS_ADDR A:0x61e1e038
y.create.l HWIO_TCU_APPS_SMMU_CB15_PRRR_MAIR0_2_APPS_ADDR A:0x61e1f038
y.create.l HWIO_TCU_APPS_SMMU_CB0_NMRR_MAIR1_2_APPS_ADDR A:0x61e1003c
y.create.l HWIO_TCU_APPS_SMMU_CB1_NMRR_MAIR1_2_APPS_ADDR A:0x61e1103c
y.create.l HWIO_TCU_APPS_SMMU_CB2_NMRR_MAIR1_2_APPS_ADDR A:0x61e1203c
y.create.l HWIO_TCU_APPS_SMMU_CB3_NMRR_MAIR1_2_APPS_ADDR A:0x61e1303c
y.create.l HWIO_TCU_APPS_SMMU_CB4_NMRR_MAIR1_2_APPS_ADDR A:0x61e1403c
y.create.l HWIO_TCU_APPS_SMMU_CB5_NMRR_MAIR1_2_APPS_ADDR A:0x61e1503c
y.create.l HWIO_TCU_APPS_SMMU_CB6_NMRR_MAIR1_2_APPS_ADDR A:0x61e1603c
y.create.l HWIO_TCU_APPS_SMMU_CB7_NMRR_MAIR1_2_APPS_ADDR A:0x61e1703c
y.create.l HWIO_TCU_APPS_SMMU_CB8_NMRR_MAIR1_2_APPS_ADDR A:0x61e1803c
y.create.l HWIO_TCU_APPS_SMMU_CB9_NMRR_MAIR1_2_APPS_ADDR A:0x61e1903c
y.create.l HWIO_TCU_APPS_SMMU_CB10_NMRR_MAIR1_2_APPS_ADDR A:0x61e1a03c
y.create.l HWIO_TCU_APPS_SMMU_CB11_NMRR_MAIR1_2_APPS_ADDR A:0x61e1b03c
y.create.l HWIO_TCU_APPS_SMMU_CB12_NMRR_MAIR1_2_APPS_ADDR A:0x61e1c03c
y.create.l HWIO_TCU_APPS_SMMU_CB13_NMRR_MAIR1_2_APPS_ADDR A:0x61e1d03c
y.create.l HWIO_TCU_APPS_SMMU_CB14_NMRR_MAIR1_2_APPS_ADDR A:0x61e1e03c
y.create.l HWIO_TCU_APPS_SMMU_CB15_NMRR_MAIR1_2_APPS_ADDR A:0x61e1f03c
y.create.l HWIO_TCU_APPS_SMMU_CB0_FSR_2_APPS_ADDR A:0x61e10058
y.create.l HWIO_TCU_APPS_SMMU_CB1_FSR_2_APPS_ADDR A:0x61e11058
y.create.l HWIO_TCU_APPS_SMMU_CB2_FSR_2_APPS_ADDR A:0x61e12058
y.create.l HWIO_TCU_APPS_SMMU_CB3_FSR_2_APPS_ADDR A:0x61e13058
y.create.l HWIO_TCU_APPS_SMMU_CB4_FSR_2_APPS_ADDR A:0x61e14058
y.create.l HWIO_TCU_APPS_SMMU_CB5_FSR_2_APPS_ADDR A:0x61e15058
y.create.l HWIO_TCU_APPS_SMMU_CB6_FSR_2_APPS_ADDR A:0x61e16058
y.create.l HWIO_TCU_APPS_SMMU_CB7_FSR_2_APPS_ADDR A:0x61e17058
y.create.l HWIO_TCU_APPS_SMMU_CB8_FSR_2_APPS_ADDR A:0x61e18058
y.create.l HWIO_TCU_APPS_SMMU_CB9_FSR_2_APPS_ADDR A:0x61e19058
y.create.l HWIO_TCU_APPS_SMMU_CB10_FSR_2_APPS_ADDR A:0x61e1a058
y.create.l HWIO_TCU_APPS_SMMU_CB11_FSR_2_APPS_ADDR A:0x61e1b058
y.create.l HWIO_TCU_APPS_SMMU_CB12_FSR_2_APPS_ADDR A:0x61e1c058
y.create.l HWIO_TCU_APPS_SMMU_CB13_FSR_2_APPS_ADDR A:0x61e1d058
y.create.l HWIO_TCU_APPS_SMMU_CB14_FSR_2_APPS_ADDR A:0x61e1e058
y.create.l HWIO_TCU_APPS_SMMU_CB15_FSR_2_APPS_ADDR A:0x61e1f058
y.create.l HWIO_TCU_APPS_SMMU_CB0_FSRRESTORE_2_APPS_ADDR A:0x61e1005c
y.create.l HWIO_TCU_APPS_SMMU_CB1_FSRRESTORE_2_APPS_ADDR A:0x61e1105c
y.create.l HWIO_TCU_APPS_SMMU_CB2_FSRRESTORE_2_APPS_ADDR A:0x61e1205c
y.create.l HWIO_TCU_APPS_SMMU_CB3_FSRRESTORE_2_APPS_ADDR A:0x61e1305c
y.create.l HWIO_TCU_APPS_SMMU_CB4_FSRRESTORE_2_APPS_ADDR A:0x61e1405c
y.create.l HWIO_TCU_APPS_SMMU_CB5_FSRRESTORE_2_APPS_ADDR A:0x61e1505c
y.create.l HWIO_TCU_APPS_SMMU_CB6_FSRRESTORE_2_APPS_ADDR A:0x61e1605c
y.create.l HWIO_TCU_APPS_SMMU_CB7_FSRRESTORE_2_APPS_ADDR A:0x61e1705c
y.create.l HWIO_TCU_APPS_SMMU_CB8_FSRRESTORE_2_APPS_ADDR A:0x61e1805c
y.create.l HWIO_TCU_APPS_SMMU_CB9_FSRRESTORE_2_APPS_ADDR A:0x61e1905c
y.create.l HWIO_TCU_APPS_SMMU_CB10_FSRRESTORE_2_APPS_ADDR A:0x61e1a05c
y.create.l HWIO_TCU_APPS_SMMU_CB11_FSRRESTORE_2_APPS_ADDR A:0x61e1b05c
y.create.l HWIO_TCU_APPS_SMMU_CB12_FSRRESTORE_2_APPS_ADDR A:0x61e1c05c
y.create.l HWIO_TCU_APPS_SMMU_CB13_FSRRESTORE_2_APPS_ADDR A:0x61e1d05c
y.create.l HWIO_TCU_APPS_SMMU_CB14_FSRRESTORE_2_APPS_ADDR A:0x61e1e05c
y.create.l HWIO_TCU_APPS_SMMU_CB15_FSRRESTORE_2_APPS_ADDR A:0x61e1f05c
y.create.l HWIO_TCU_APPS_SMMU_CB0_FAR_LOW_2_APPS_ADDR A:0x61e10060
y.create.l HWIO_TCU_APPS_SMMU_CB1_FAR_LOW_2_APPS_ADDR A:0x61e11060
y.create.l HWIO_TCU_APPS_SMMU_CB2_FAR_LOW_2_APPS_ADDR A:0x61e12060
y.create.l HWIO_TCU_APPS_SMMU_CB3_FAR_LOW_2_APPS_ADDR A:0x61e13060
y.create.l HWIO_TCU_APPS_SMMU_CB4_FAR_LOW_2_APPS_ADDR A:0x61e14060
y.create.l HWIO_TCU_APPS_SMMU_CB5_FAR_LOW_2_APPS_ADDR A:0x61e15060
y.create.l HWIO_TCU_APPS_SMMU_CB6_FAR_LOW_2_APPS_ADDR A:0x61e16060
y.create.l HWIO_TCU_APPS_SMMU_CB7_FAR_LOW_2_APPS_ADDR A:0x61e17060
y.create.l HWIO_TCU_APPS_SMMU_CB8_FAR_LOW_2_APPS_ADDR A:0x61e18060
y.create.l HWIO_TCU_APPS_SMMU_CB9_FAR_LOW_2_APPS_ADDR A:0x61e19060
y.create.l HWIO_TCU_APPS_SMMU_CB10_FAR_LOW_2_APPS_ADDR A:0x61e1a060
y.create.l HWIO_TCU_APPS_SMMU_CB11_FAR_LOW_2_APPS_ADDR A:0x61e1b060
y.create.l HWIO_TCU_APPS_SMMU_CB12_FAR_LOW_2_APPS_ADDR A:0x61e1c060
y.create.l HWIO_TCU_APPS_SMMU_CB13_FAR_LOW_2_APPS_ADDR A:0x61e1d060
y.create.l HWIO_TCU_APPS_SMMU_CB14_FAR_LOW_2_APPS_ADDR A:0x61e1e060
y.create.l HWIO_TCU_APPS_SMMU_CB15_FAR_LOW_2_APPS_ADDR A:0x61e1f060
y.create.l HWIO_TCU_APPS_SMMU_CB0_FAR_HIGH_2_APPS_ADDR A:0x61e10064
y.create.l HWIO_TCU_APPS_SMMU_CB1_FAR_HIGH_2_APPS_ADDR A:0x61e11064
y.create.l HWIO_TCU_APPS_SMMU_CB2_FAR_HIGH_2_APPS_ADDR A:0x61e12064
y.create.l HWIO_TCU_APPS_SMMU_CB3_FAR_HIGH_2_APPS_ADDR A:0x61e13064
y.create.l HWIO_TCU_APPS_SMMU_CB4_FAR_HIGH_2_APPS_ADDR A:0x61e14064
y.create.l HWIO_TCU_APPS_SMMU_CB5_FAR_HIGH_2_APPS_ADDR A:0x61e15064
y.create.l HWIO_TCU_APPS_SMMU_CB6_FAR_HIGH_2_APPS_ADDR A:0x61e16064
y.create.l HWIO_TCU_APPS_SMMU_CB7_FAR_HIGH_2_APPS_ADDR A:0x61e17064
y.create.l HWIO_TCU_APPS_SMMU_CB8_FAR_HIGH_2_APPS_ADDR A:0x61e18064
y.create.l HWIO_TCU_APPS_SMMU_CB9_FAR_HIGH_2_APPS_ADDR A:0x61e19064
y.create.l HWIO_TCU_APPS_SMMU_CB10_FAR_HIGH_2_APPS_ADDR A:0x61e1a064
y.create.l HWIO_TCU_APPS_SMMU_CB11_FAR_HIGH_2_APPS_ADDR A:0x61e1b064
y.create.l HWIO_TCU_APPS_SMMU_CB12_FAR_HIGH_2_APPS_ADDR A:0x61e1c064
y.create.l HWIO_TCU_APPS_SMMU_CB13_FAR_HIGH_2_APPS_ADDR A:0x61e1d064
y.create.l HWIO_TCU_APPS_SMMU_CB14_FAR_HIGH_2_APPS_ADDR A:0x61e1e064
y.create.l HWIO_TCU_APPS_SMMU_CB15_FAR_HIGH_2_APPS_ADDR A:0x61e1f064
y.create.l HWIO_TCU_APPS_SMMU_CB0_FSYNR0_2_APPS_ADDR A:0x61e10068
y.create.l HWIO_TCU_APPS_SMMU_CB1_FSYNR0_2_APPS_ADDR A:0x61e11068
y.create.l HWIO_TCU_APPS_SMMU_CB2_FSYNR0_2_APPS_ADDR A:0x61e12068
y.create.l HWIO_TCU_APPS_SMMU_CB3_FSYNR0_2_APPS_ADDR A:0x61e13068
y.create.l HWIO_TCU_APPS_SMMU_CB4_FSYNR0_2_APPS_ADDR A:0x61e14068
y.create.l HWIO_TCU_APPS_SMMU_CB5_FSYNR0_2_APPS_ADDR A:0x61e15068
y.create.l HWIO_TCU_APPS_SMMU_CB6_FSYNR0_2_APPS_ADDR A:0x61e16068
y.create.l HWIO_TCU_APPS_SMMU_CB7_FSYNR0_2_APPS_ADDR A:0x61e17068
y.create.l HWIO_TCU_APPS_SMMU_CB8_FSYNR0_2_APPS_ADDR A:0x61e18068
y.create.l HWIO_TCU_APPS_SMMU_CB9_FSYNR0_2_APPS_ADDR A:0x61e19068
y.create.l HWIO_TCU_APPS_SMMU_CB10_FSYNR0_2_APPS_ADDR A:0x61e1a068
y.create.l HWIO_TCU_APPS_SMMU_CB11_FSYNR0_2_APPS_ADDR A:0x61e1b068
y.create.l HWIO_TCU_APPS_SMMU_CB12_FSYNR0_2_APPS_ADDR A:0x61e1c068
y.create.l HWIO_TCU_APPS_SMMU_CB13_FSYNR0_2_APPS_ADDR A:0x61e1d068
y.create.l HWIO_TCU_APPS_SMMU_CB14_FSYNR0_2_APPS_ADDR A:0x61e1e068
y.create.l HWIO_TCU_APPS_SMMU_CB15_FSYNR0_2_APPS_ADDR A:0x61e1f068
y.create.l HWIO_TCU_APPS_SMMU_CB0_IPAFAR_LOW_2_APPS_ADDR A:0x61e10070
y.create.l HWIO_TCU_APPS_SMMU_CB1_IPAFAR_LOW_2_APPS_ADDR A:0x61e11070
y.create.l HWIO_TCU_APPS_SMMU_CB2_IPAFAR_LOW_2_APPS_ADDR A:0x61e12070
y.create.l HWIO_TCU_APPS_SMMU_CB3_IPAFAR_LOW_2_APPS_ADDR A:0x61e13070
y.create.l HWIO_TCU_APPS_SMMU_CB4_IPAFAR_LOW_2_APPS_ADDR A:0x61e14070
y.create.l HWIO_TCU_APPS_SMMU_CB5_IPAFAR_LOW_2_APPS_ADDR A:0x61e15070
y.create.l HWIO_TCU_APPS_SMMU_CB6_IPAFAR_LOW_2_APPS_ADDR A:0x61e16070
y.create.l HWIO_TCU_APPS_SMMU_CB7_IPAFAR_LOW_2_APPS_ADDR A:0x61e17070
y.create.l HWIO_TCU_APPS_SMMU_CB8_IPAFAR_LOW_2_APPS_ADDR A:0x61e18070
y.create.l HWIO_TCU_APPS_SMMU_CB9_IPAFAR_LOW_2_APPS_ADDR A:0x61e19070
y.create.l HWIO_TCU_APPS_SMMU_CB10_IPAFAR_LOW_2_APPS_ADDR A:0x61e1a070
y.create.l HWIO_TCU_APPS_SMMU_CB11_IPAFAR_LOW_2_APPS_ADDR A:0x61e1b070
y.create.l HWIO_TCU_APPS_SMMU_CB12_IPAFAR_LOW_2_APPS_ADDR A:0x61e1c070
y.create.l HWIO_TCU_APPS_SMMU_CB13_IPAFAR_LOW_2_APPS_ADDR A:0x61e1d070
y.create.l HWIO_TCU_APPS_SMMU_CB14_IPAFAR_LOW_2_APPS_ADDR A:0x61e1e070
y.create.l HWIO_TCU_APPS_SMMU_CB15_IPAFAR_LOW_2_APPS_ADDR A:0x61e1f070
y.create.l HWIO_TCU_APPS_SMMU_CB0_IPAFAR_HIGH_2_APPS_ADDR A:0x61e10074
y.create.l HWIO_TCU_APPS_SMMU_CB1_IPAFAR_HIGH_2_APPS_ADDR A:0x61e11074
y.create.l HWIO_TCU_APPS_SMMU_CB2_IPAFAR_HIGH_2_APPS_ADDR A:0x61e12074
y.create.l HWIO_TCU_APPS_SMMU_CB3_IPAFAR_HIGH_2_APPS_ADDR A:0x61e13074
y.create.l HWIO_TCU_APPS_SMMU_CB4_IPAFAR_HIGH_2_APPS_ADDR A:0x61e14074
y.create.l HWIO_TCU_APPS_SMMU_CB5_IPAFAR_HIGH_2_APPS_ADDR A:0x61e15074
y.create.l HWIO_TCU_APPS_SMMU_CB6_IPAFAR_HIGH_2_APPS_ADDR A:0x61e16074
y.create.l HWIO_TCU_APPS_SMMU_CB7_IPAFAR_HIGH_2_APPS_ADDR A:0x61e17074
y.create.l HWIO_TCU_APPS_SMMU_CB8_IPAFAR_HIGH_2_APPS_ADDR A:0x61e18074
y.create.l HWIO_TCU_APPS_SMMU_CB9_IPAFAR_HIGH_2_APPS_ADDR A:0x61e19074
y.create.l HWIO_TCU_APPS_SMMU_CB10_IPAFAR_HIGH_2_APPS_ADDR A:0x61e1a074
y.create.l HWIO_TCU_APPS_SMMU_CB11_IPAFAR_HIGH_2_APPS_ADDR A:0x61e1b074
y.create.l HWIO_TCU_APPS_SMMU_CB12_IPAFAR_HIGH_2_APPS_ADDR A:0x61e1c074
y.create.l HWIO_TCU_APPS_SMMU_CB13_IPAFAR_HIGH_2_APPS_ADDR A:0x61e1d074
y.create.l HWIO_TCU_APPS_SMMU_CB14_IPAFAR_HIGH_2_APPS_ADDR A:0x61e1e074
y.create.l HWIO_TCU_APPS_SMMU_CB15_IPAFAR_HIGH_2_APPS_ADDR A:0x61e1f074
y.create.l HWIO_TCU_APPS_SMMU_CB0_TLBIVA_LOW_2_APPS_ADDR A:0x61e10600
y.create.l HWIO_TCU_APPS_SMMU_CB1_TLBIVA_LOW_2_APPS_ADDR A:0x61e11600
y.create.l HWIO_TCU_APPS_SMMU_CB2_TLBIVA_LOW_2_APPS_ADDR A:0x61e12600
y.create.l HWIO_TCU_APPS_SMMU_CB3_TLBIVA_LOW_2_APPS_ADDR A:0x61e13600
y.create.l HWIO_TCU_APPS_SMMU_CB4_TLBIVA_LOW_2_APPS_ADDR A:0x61e14600
y.create.l HWIO_TCU_APPS_SMMU_CB5_TLBIVA_LOW_2_APPS_ADDR A:0x61e15600
y.create.l HWIO_TCU_APPS_SMMU_CB6_TLBIVA_LOW_2_APPS_ADDR A:0x61e16600
y.create.l HWIO_TCU_APPS_SMMU_CB7_TLBIVA_LOW_2_APPS_ADDR A:0x61e17600
y.create.l HWIO_TCU_APPS_SMMU_CB8_TLBIVA_LOW_2_APPS_ADDR A:0x61e18600
y.create.l HWIO_TCU_APPS_SMMU_CB9_TLBIVA_LOW_2_APPS_ADDR A:0x61e19600
y.create.l HWIO_TCU_APPS_SMMU_CB10_TLBIVA_LOW_2_APPS_ADDR A:0x61e1a600
y.create.l HWIO_TCU_APPS_SMMU_CB11_TLBIVA_LOW_2_APPS_ADDR A:0x61e1b600
y.create.l HWIO_TCU_APPS_SMMU_CB12_TLBIVA_LOW_2_APPS_ADDR A:0x61e1c600
y.create.l HWIO_TCU_APPS_SMMU_CB13_TLBIVA_LOW_2_APPS_ADDR A:0x61e1d600
y.create.l HWIO_TCU_APPS_SMMU_CB14_TLBIVA_LOW_2_APPS_ADDR A:0x61e1e600
y.create.l HWIO_TCU_APPS_SMMU_CB15_TLBIVA_LOW_2_APPS_ADDR A:0x61e1f600
y.create.l HWIO_TCU_APPS_SMMU_CB0_TLBIVA_HIGH_2_APPS_ADDR A:0x61e10604
y.create.l HWIO_TCU_APPS_SMMU_CB1_TLBIVA_HIGH_2_APPS_ADDR A:0x61e11604
y.create.l HWIO_TCU_APPS_SMMU_CB2_TLBIVA_HIGH_2_APPS_ADDR A:0x61e12604
y.create.l HWIO_TCU_APPS_SMMU_CB3_TLBIVA_HIGH_2_APPS_ADDR A:0x61e13604
y.create.l HWIO_TCU_APPS_SMMU_CB4_TLBIVA_HIGH_2_APPS_ADDR A:0x61e14604
y.create.l HWIO_TCU_APPS_SMMU_CB5_TLBIVA_HIGH_2_APPS_ADDR A:0x61e15604
y.create.l HWIO_TCU_APPS_SMMU_CB6_TLBIVA_HIGH_2_APPS_ADDR A:0x61e16604
y.create.l HWIO_TCU_APPS_SMMU_CB7_TLBIVA_HIGH_2_APPS_ADDR A:0x61e17604
y.create.l HWIO_TCU_APPS_SMMU_CB8_TLBIVA_HIGH_2_APPS_ADDR A:0x61e18604
y.create.l HWIO_TCU_APPS_SMMU_CB9_TLBIVA_HIGH_2_APPS_ADDR A:0x61e19604
y.create.l HWIO_TCU_APPS_SMMU_CB10_TLBIVA_HIGH_2_APPS_ADDR A:0x61e1a604
y.create.l HWIO_TCU_APPS_SMMU_CB11_TLBIVA_HIGH_2_APPS_ADDR A:0x61e1b604
y.create.l HWIO_TCU_APPS_SMMU_CB12_TLBIVA_HIGH_2_APPS_ADDR A:0x61e1c604
y.create.l HWIO_TCU_APPS_SMMU_CB13_TLBIVA_HIGH_2_APPS_ADDR A:0x61e1d604
y.create.l HWIO_TCU_APPS_SMMU_CB14_TLBIVA_HIGH_2_APPS_ADDR A:0x61e1e604
y.create.l HWIO_TCU_APPS_SMMU_CB15_TLBIVA_HIGH_2_APPS_ADDR A:0x61e1f604
y.create.l HWIO_TCU_APPS_SMMU_CB0_TLBIVAA_LOW_2_APPS_ADDR A:0x61e10608
y.create.l HWIO_TCU_APPS_SMMU_CB1_TLBIVAA_LOW_2_APPS_ADDR A:0x61e11608
y.create.l HWIO_TCU_APPS_SMMU_CB2_TLBIVAA_LOW_2_APPS_ADDR A:0x61e12608
y.create.l HWIO_TCU_APPS_SMMU_CB3_TLBIVAA_LOW_2_APPS_ADDR A:0x61e13608
y.create.l HWIO_TCU_APPS_SMMU_CB4_TLBIVAA_LOW_2_APPS_ADDR A:0x61e14608
y.create.l HWIO_TCU_APPS_SMMU_CB5_TLBIVAA_LOW_2_APPS_ADDR A:0x61e15608
y.create.l HWIO_TCU_APPS_SMMU_CB6_TLBIVAA_LOW_2_APPS_ADDR A:0x61e16608
y.create.l HWIO_TCU_APPS_SMMU_CB7_TLBIVAA_LOW_2_APPS_ADDR A:0x61e17608
y.create.l HWIO_TCU_APPS_SMMU_CB8_TLBIVAA_LOW_2_APPS_ADDR A:0x61e18608
y.create.l HWIO_TCU_APPS_SMMU_CB9_TLBIVAA_LOW_2_APPS_ADDR A:0x61e19608
y.create.l HWIO_TCU_APPS_SMMU_CB10_TLBIVAA_LOW_2_APPS_ADDR A:0x61e1a608
y.create.l HWIO_TCU_APPS_SMMU_CB11_TLBIVAA_LOW_2_APPS_ADDR A:0x61e1b608
y.create.l HWIO_TCU_APPS_SMMU_CB12_TLBIVAA_LOW_2_APPS_ADDR A:0x61e1c608
y.create.l HWIO_TCU_APPS_SMMU_CB13_TLBIVAA_LOW_2_APPS_ADDR A:0x61e1d608
y.create.l HWIO_TCU_APPS_SMMU_CB14_TLBIVAA_LOW_2_APPS_ADDR A:0x61e1e608
y.create.l HWIO_TCU_APPS_SMMU_CB15_TLBIVAA_LOW_2_APPS_ADDR A:0x61e1f608
y.create.l HWIO_TCU_APPS_SMMU_CB0_TLBIVAA_HIGH_2_APPS_ADDR A:0x61e1060c
y.create.l HWIO_TCU_APPS_SMMU_CB1_TLBIVAA_HIGH_2_APPS_ADDR A:0x61e1160c
y.create.l HWIO_TCU_APPS_SMMU_CB2_TLBIVAA_HIGH_2_APPS_ADDR A:0x61e1260c
y.create.l HWIO_TCU_APPS_SMMU_CB3_TLBIVAA_HIGH_2_APPS_ADDR A:0x61e1360c
y.create.l HWIO_TCU_APPS_SMMU_CB4_TLBIVAA_HIGH_2_APPS_ADDR A:0x61e1460c
y.create.l HWIO_TCU_APPS_SMMU_CB5_TLBIVAA_HIGH_2_APPS_ADDR A:0x61e1560c
y.create.l HWIO_TCU_APPS_SMMU_CB6_TLBIVAA_HIGH_2_APPS_ADDR A:0x61e1660c
y.create.l HWIO_TCU_APPS_SMMU_CB7_TLBIVAA_HIGH_2_APPS_ADDR A:0x61e1760c
y.create.l HWIO_TCU_APPS_SMMU_CB8_TLBIVAA_HIGH_2_APPS_ADDR A:0x61e1860c
y.create.l HWIO_TCU_APPS_SMMU_CB9_TLBIVAA_HIGH_2_APPS_ADDR A:0x61e1960c
y.create.l HWIO_TCU_APPS_SMMU_CB10_TLBIVAA_HIGH_2_APPS_ADDR A:0x61e1a60c
y.create.l HWIO_TCU_APPS_SMMU_CB11_TLBIVAA_HIGH_2_APPS_ADDR A:0x61e1b60c
y.create.l HWIO_TCU_APPS_SMMU_CB12_TLBIVAA_HIGH_2_APPS_ADDR A:0x61e1c60c
y.create.l HWIO_TCU_APPS_SMMU_CB13_TLBIVAA_HIGH_2_APPS_ADDR A:0x61e1d60c
y.create.l HWIO_TCU_APPS_SMMU_CB14_TLBIVAA_HIGH_2_APPS_ADDR A:0x61e1e60c
y.create.l HWIO_TCU_APPS_SMMU_CB15_TLBIVAA_HIGH_2_APPS_ADDR A:0x61e1f60c
y.create.l HWIO_TCU_APPS_SMMU_CB0_TLBIASID_2_APPS_ADDR A:0x61e10610
y.create.l HWIO_TCU_APPS_SMMU_CB1_TLBIASID_2_APPS_ADDR A:0x61e11610
y.create.l HWIO_TCU_APPS_SMMU_CB2_TLBIASID_2_APPS_ADDR A:0x61e12610
y.create.l HWIO_TCU_APPS_SMMU_CB3_TLBIASID_2_APPS_ADDR A:0x61e13610
y.create.l HWIO_TCU_APPS_SMMU_CB4_TLBIASID_2_APPS_ADDR A:0x61e14610
y.create.l HWIO_TCU_APPS_SMMU_CB5_TLBIASID_2_APPS_ADDR A:0x61e15610
y.create.l HWIO_TCU_APPS_SMMU_CB6_TLBIASID_2_APPS_ADDR A:0x61e16610
y.create.l HWIO_TCU_APPS_SMMU_CB7_TLBIASID_2_APPS_ADDR A:0x61e17610
y.create.l HWIO_TCU_APPS_SMMU_CB8_TLBIASID_2_APPS_ADDR A:0x61e18610
y.create.l HWIO_TCU_APPS_SMMU_CB9_TLBIASID_2_APPS_ADDR A:0x61e19610
y.create.l HWIO_TCU_APPS_SMMU_CB10_TLBIASID_2_APPS_ADDR A:0x61e1a610
y.create.l HWIO_TCU_APPS_SMMU_CB11_TLBIASID_2_APPS_ADDR A:0x61e1b610
y.create.l HWIO_TCU_APPS_SMMU_CB12_TLBIASID_2_APPS_ADDR A:0x61e1c610
y.create.l HWIO_TCU_APPS_SMMU_CB13_TLBIASID_2_APPS_ADDR A:0x61e1d610
y.create.l HWIO_TCU_APPS_SMMU_CB14_TLBIASID_2_APPS_ADDR A:0x61e1e610
y.create.l HWIO_TCU_APPS_SMMU_CB15_TLBIASID_2_APPS_ADDR A:0x61e1f610
y.create.l HWIO_TCU_APPS_SMMU_CB0_TLBIALL_2_APPS_ADDR A:0x61e10618
y.create.l HWIO_TCU_APPS_SMMU_CB1_TLBIALL_2_APPS_ADDR A:0x61e11618
y.create.l HWIO_TCU_APPS_SMMU_CB2_TLBIALL_2_APPS_ADDR A:0x61e12618
y.create.l HWIO_TCU_APPS_SMMU_CB3_TLBIALL_2_APPS_ADDR A:0x61e13618
y.create.l HWIO_TCU_APPS_SMMU_CB4_TLBIALL_2_APPS_ADDR A:0x61e14618
y.create.l HWIO_TCU_APPS_SMMU_CB5_TLBIALL_2_APPS_ADDR A:0x61e15618
y.create.l HWIO_TCU_APPS_SMMU_CB6_TLBIALL_2_APPS_ADDR A:0x61e16618
y.create.l HWIO_TCU_APPS_SMMU_CB7_TLBIALL_2_APPS_ADDR A:0x61e17618
y.create.l HWIO_TCU_APPS_SMMU_CB8_TLBIALL_2_APPS_ADDR A:0x61e18618
y.create.l HWIO_TCU_APPS_SMMU_CB9_TLBIALL_2_APPS_ADDR A:0x61e19618
y.create.l HWIO_TCU_APPS_SMMU_CB10_TLBIALL_2_APPS_ADDR A:0x61e1a618
y.create.l HWIO_TCU_APPS_SMMU_CB11_TLBIALL_2_APPS_ADDR A:0x61e1b618
y.create.l HWIO_TCU_APPS_SMMU_CB12_TLBIALL_2_APPS_ADDR A:0x61e1c618
y.create.l HWIO_TCU_APPS_SMMU_CB13_TLBIALL_2_APPS_ADDR A:0x61e1d618
y.create.l HWIO_TCU_APPS_SMMU_CB14_TLBIALL_2_APPS_ADDR A:0x61e1e618
y.create.l HWIO_TCU_APPS_SMMU_CB15_TLBIALL_2_APPS_ADDR A:0x61e1f618
y.create.l HWIO_TCU_APPS_SMMU_CB0_TLBIVAL_LOW_2_APPS_ADDR A:0x61e10620
y.create.l HWIO_TCU_APPS_SMMU_CB1_TLBIVAL_LOW_2_APPS_ADDR A:0x61e11620
y.create.l HWIO_TCU_APPS_SMMU_CB2_TLBIVAL_LOW_2_APPS_ADDR A:0x61e12620
y.create.l HWIO_TCU_APPS_SMMU_CB3_TLBIVAL_LOW_2_APPS_ADDR A:0x61e13620
y.create.l HWIO_TCU_APPS_SMMU_CB4_TLBIVAL_LOW_2_APPS_ADDR A:0x61e14620
y.create.l HWIO_TCU_APPS_SMMU_CB5_TLBIVAL_LOW_2_APPS_ADDR A:0x61e15620
y.create.l HWIO_TCU_APPS_SMMU_CB6_TLBIVAL_LOW_2_APPS_ADDR A:0x61e16620
y.create.l HWIO_TCU_APPS_SMMU_CB7_TLBIVAL_LOW_2_APPS_ADDR A:0x61e17620
y.create.l HWIO_TCU_APPS_SMMU_CB8_TLBIVAL_LOW_2_APPS_ADDR A:0x61e18620
y.create.l HWIO_TCU_APPS_SMMU_CB9_TLBIVAL_LOW_2_APPS_ADDR A:0x61e19620
y.create.l HWIO_TCU_APPS_SMMU_CB10_TLBIVAL_LOW_2_APPS_ADDR A:0x61e1a620
y.create.l HWIO_TCU_APPS_SMMU_CB11_TLBIVAL_LOW_2_APPS_ADDR A:0x61e1b620
y.create.l HWIO_TCU_APPS_SMMU_CB12_TLBIVAL_LOW_2_APPS_ADDR A:0x61e1c620
y.create.l HWIO_TCU_APPS_SMMU_CB13_TLBIVAL_LOW_2_APPS_ADDR A:0x61e1d620
y.create.l HWIO_TCU_APPS_SMMU_CB14_TLBIVAL_LOW_2_APPS_ADDR A:0x61e1e620
y.create.l HWIO_TCU_APPS_SMMU_CB15_TLBIVAL_LOW_2_APPS_ADDR A:0x61e1f620
y.create.l HWIO_TCU_APPS_SMMU_CB0_TLBIVAL_HIGH_2_APPS_ADDR A:0x61e10624
y.create.l HWIO_TCU_APPS_SMMU_CB1_TLBIVAL_HIGH_2_APPS_ADDR A:0x61e11624
y.create.l HWIO_TCU_APPS_SMMU_CB2_TLBIVAL_HIGH_2_APPS_ADDR A:0x61e12624
y.create.l HWIO_TCU_APPS_SMMU_CB3_TLBIVAL_HIGH_2_APPS_ADDR A:0x61e13624
y.create.l HWIO_TCU_APPS_SMMU_CB4_TLBIVAL_HIGH_2_APPS_ADDR A:0x61e14624
y.create.l HWIO_TCU_APPS_SMMU_CB5_TLBIVAL_HIGH_2_APPS_ADDR A:0x61e15624
y.create.l HWIO_TCU_APPS_SMMU_CB6_TLBIVAL_HIGH_2_APPS_ADDR A:0x61e16624
y.create.l HWIO_TCU_APPS_SMMU_CB7_TLBIVAL_HIGH_2_APPS_ADDR A:0x61e17624
y.create.l HWIO_TCU_APPS_SMMU_CB8_TLBIVAL_HIGH_2_APPS_ADDR A:0x61e18624
y.create.l HWIO_TCU_APPS_SMMU_CB9_TLBIVAL_HIGH_2_APPS_ADDR A:0x61e19624
y.create.l HWIO_TCU_APPS_SMMU_CB10_TLBIVAL_HIGH_2_APPS_ADDR A:0x61e1a624
y.create.l HWIO_TCU_APPS_SMMU_CB11_TLBIVAL_HIGH_2_APPS_ADDR A:0x61e1b624
y.create.l HWIO_TCU_APPS_SMMU_CB12_TLBIVAL_HIGH_2_APPS_ADDR A:0x61e1c624
y.create.l HWIO_TCU_APPS_SMMU_CB13_TLBIVAL_HIGH_2_APPS_ADDR A:0x61e1d624
y.create.l HWIO_TCU_APPS_SMMU_CB14_TLBIVAL_HIGH_2_APPS_ADDR A:0x61e1e624
y.create.l HWIO_TCU_APPS_SMMU_CB15_TLBIVAL_HIGH_2_APPS_ADDR A:0x61e1f624
y.create.l HWIO_TCU_APPS_SMMU_CB0_TLBIVAAL_LOW_2_APPS_ADDR A:0x61e10628
y.create.l HWIO_TCU_APPS_SMMU_CB1_TLBIVAAL_LOW_2_APPS_ADDR A:0x61e11628
y.create.l HWIO_TCU_APPS_SMMU_CB2_TLBIVAAL_LOW_2_APPS_ADDR A:0x61e12628
y.create.l HWIO_TCU_APPS_SMMU_CB3_TLBIVAAL_LOW_2_APPS_ADDR A:0x61e13628
y.create.l HWIO_TCU_APPS_SMMU_CB4_TLBIVAAL_LOW_2_APPS_ADDR A:0x61e14628
y.create.l HWIO_TCU_APPS_SMMU_CB5_TLBIVAAL_LOW_2_APPS_ADDR A:0x61e15628
y.create.l HWIO_TCU_APPS_SMMU_CB6_TLBIVAAL_LOW_2_APPS_ADDR A:0x61e16628
y.create.l HWIO_TCU_APPS_SMMU_CB7_TLBIVAAL_LOW_2_APPS_ADDR A:0x61e17628
y.create.l HWIO_TCU_APPS_SMMU_CB8_TLBIVAAL_LOW_2_APPS_ADDR A:0x61e18628
y.create.l HWIO_TCU_APPS_SMMU_CB9_TLBIVAAL_LOW_2_APPS_ADDR A:0x61e19628
y.create.l HWIO_TCU_APPS_SMMU_CB10_TLBIVAAL_LOW_2_APPS_ADDR A:0x61e1a628
y.create.l HWIO_TCU_APPS_SMMU_CB11_TLBIVAAL_LOW_2_APPS_ADDR A:0x61e1b628
y.create.l HWIO_TCU_APPS_SMMU_CB12_TLBIVAAL_LOW_2_APPS_ADDR A:0x61e1c628
y.create.l HWIO_TCU_APPS_SMMU_CB13_TLBIVAAL_LOW_2_APPS_ADDR A:0x61e1d628
y.create.l HWIO_TCU_APPS_SMMU_CB14_TLBIVAAL_LOW_2_APPS_ADDR A:0x61e1e628
y.create.l HWIO_TCU_APPS_SMMU_CB15_TLBIVAAL_LOW_2_APPS_ADDR A:0x61e1f628
y.create.l HWIO_TCU_APPS_SMMU_CB0_TLBIVAAL_HIGH_2_APPS_ADDR A:0x61e1062c
y.create.l HWIO_TCU_APPS_SMMU_CB1_TLBIVAAL_HIGH_2_APPS_ADDR A:0x61e1162c
y.create.l HWIO_TCU_APPS_SMMU_CB2_TLBIVAAL_HIGH_2_APPS_ADDR A:0x61e1262c
y.create.l HWIO_TCU_APPS_SMMU_CB3_TLBIVAAL_HIGH_2_APPS_ADDR A:0x61e1362c
y.create.l HWIO_TCU_APPS_SMMU_CB4_TLBIVAAL_HIGH_2_APPS_ADDR A:0x61e1462c
y.create.l HWIO_TCU_APPS_SMMU_CB5_TLBIVAAL_HIGH_2_APPS_ADDR A:0x61e1562c
y.create.l HWIO_TCU_APPS_SMMU_CB6_TLBIVAAL_HIGH_2_APPS_ADDR A:0x61e1662c
y.create.l HWIO_TCU_APPS_SMMU_CB7_TLBIVAAL_HIGH_2_APPS_ADDR A:0x61e1762c
y.create.l HWIO_TCU_APPS_SMMU_CB8_TLBIVAAL_HIGH_2_APPS_ADDR A:0x61e1862c
y.create.l HWIO_TCU_APPS_SMMU_CB9_TLBIVAAL_HIGH_2_APPS_ADDR A:0x61e1962c
y.create.l HWIO_TCU_APPS_SMMU_CB10_TLBIVAAL_HIGH_2_APPS_ADDR A:0x61e1a62c
y.create.l HWIO_TCU_APPS_SMMU_CB11_TLBIVAAL_HIGH_2_APPS_ADDR A:0x61e1b62c
y.create.l HWIO_TCU_APPS_SMMU_CB12_TLBIVAAL_HIGH_2_APPS_ADDR A:0x61e1c62c
y.create.l HWIO_TCU_APPS_SMMU_CB13_TLBIVAAL_HIGH_2_APPS_ADDR A:0x61e1d62c
y.create.l HWIO_TCU_APPS_SMMU_CB14_TLBIVAAL_HIGH_2_APPS_ADDR A:0x61e1e62c
y.create.l HWIO_TCU_APPS_SMMU_CB15_TLBIVAAL_HIGH_2_APPS_ADDR A:0x61e1f62c
y.create.l HWIO_TCU_APPS_SMMU_CB0_TLBIIPAS2_LOW_2_APPS_ADDR A:0x61e10630
y.create.l HWIO_TCU_APPS_SMMU_CB1_TLBIIPAS2_LOW_2_APPS_ADDR A:0x61e11630
y.create.l HWIO_TCU_APPS_SMMU_CB2_TLBIIPAS2_LOW_2_APPS_ADDR A:0x61e12630
y.create.l HWIO_TCU_APPS_SMMU_CB3_TLBIIPAS2_LOW_2_APPS_ADDR A:0x61e13630
y.create.l HWIO_TCU_APPS_SMMU_CB4_TLBIIPAS2_LOW_2_APPS_ADDR A:0x61e14630
y.create.l HWIO_TCU_APPS_SMMU_CB5_TLBIIPAS2_LOW_2_APPS_ADDR A:0x61e15630
y.create.l HWIO_TCU_APPS_SMMU_CB6_TLBIIPAS2_LOW_2_APPS_ADDR A:0x61e16630
y.create.l HWIO_TCU_APPS_SMMU_CB7_TLBIIPAS2_LOW_2_APPS_ADDR A:0x61e17630
y.create.l HWIO_TCU_APPS_SMMU_CB8_TLBIIPAS2_LOW_2_APPS_ADDR A:0x61e18630
y.create.l HWIO_TCU_APPS_SMMU_CB9_TLBIIPAS2_LOW_2_APPS_ADDR A:0x61e19630
y.create.l HWIO_TCU_APPS_SMMU_CB10_TLBIIPAS2_LOW_2_APPS_ADDR A:0x61e1a630
y.create.l HWIO_TCU_APPS_SMMU_CB11_TLBIIPAS2_LOW_2_APPS_ADDR A:0x61e1b630
y.create.l HWIO_TCU_APPS_SMMU_CB12_TLBIIPAS2_LOW_2_APPS_ADDR A:0x61e1c630
y.create.l HWIO_TCU_APPS_SMMU_CB13_TLBIIPAS2_LOW_2_APPS_ADDR A:0x61e1d630
y.create.l HWIO_TCU_APPS_SMMU_CB14_TLBIIPAS2_LOW_2_APPS_ADDR A:0x61e1e630
y.create.l HWIO_TCU_APPS_SMMU_CB15_TLBIIPAS2_LOW_2_APPS_ADDR A:0x61e1f630
y.create.l HWIO_TCU_APPS_SMMU_CB0_TLBIIPAS2_HIGH_2_APPS_ADDR A:0x61e10634
y.create.l HWIO_TCU_APPS_SMMU_CB1_TLBIIPAS2_HIGH_2_APPS_ADDR A:0x61e11634
y.create.l HWIO_TCU_APPS_SMMU_CB2_TLBIIPAS2_HIGH_2_APPS_ADDR A:0x61e12634
y.create.l HWIO_TCU_APPS_SMMU_CB3_TLBIIPAS2_HIGH_2_APPS_ADDR A:0x61e13634
y.create.l HWIO_TCU_APPS_SMMU_CB4_TLBIIPAS2_HIGH_2_APPS_ADDR A:0x61e14634
y.create.l HWIO_TCU_APPS_SMMU_CB5_TLBIIPAS2_HIGH_2_APPS_ADDR A:0x61e15634
y.create.l HWIO_TCU_APPS_SMMU_CB6_TLBIIPAS2_HIGH_2_APPS_ADDR A:0x61e16634
y.create.l HWIO_TCU_APPS_SMMU_CB7_TLBIIPAS2_HIGH_2_APPS_ADDR A:0x61e17634
y.create.l HWIO_TCU_APPS_SMMU_CB8_TLBIIPAS2_HIGH_2_APPS_ADDR A:0x61e18634
y.create.l HWIO_TCU_APPS_SMMU_CB9_TLBIIPAS2_HIGH_2_APPS_ADDR A:0x61e19634
y.create.l HWIO_TCU_APPS_SMMU_CB10_TLBIIPAS2_HIGH_2_APPS_ADDR A:0x61e1a634
y.create.l HWIO_TCU_APPS_SMMU_CB11_TLBIIPAS2_HIGH_2_APPS_ADDR A:0x61e1b634
y.create.l HWIO_TCU_APPS_SMMU_CB12_TLBIIPAS2_HIGH_2_APPS_ADDR A:0x61e1c634
y.create.l HWIO_TCU_APPS_SMMU_CB13_TLBIIPAS2_HIGH_2_APPS_ADDR A:0x61e1d634
y.create.l HWIO_TCU_APPS_SMMU_CB14_TLBIIPAS2_HIGH_2_APPS_ADDR A:0x61e1e634
y.create.l HWIO_TCU_APPS_SMMU_CB15_TLBIIPAS2_HIGH_2_APPS_ADDR A:0x61e1f634
y.create.l HWIO_TCU_APPS_SMMU_CB0_TLBIIPAS2L_LOW_2_APPS_ADDR A:0x61e10638
y.create.l HWIO_TCU_APPS_SMMU_CB1_TLBIIPAS2L_LOW_2_APPS_ADDR A:0x61e11638
y.create.l HWIO_TCU_APPS_SMMU_CB2_TLBIIPAS2L_LOW_2_APPS_ADDR A:0x61e12638
y.create.l HWIO_TCU_APPS_SMMU_CB3_TLBIIPAS2L_LOW_2_APPS_ADDR A:0x61e13638
y.create.l HWIO_TCU_APPS_SMMU_CB4_TLBIIPAS2L_LOW_2_APPS_ADDR A:0x61e14638
y.create.l HWIO_TCU_APPS_SMMU_CB5_TLBIIPAS2L_LOW_2_APPS_ADDR A:0x61e15638
y.create.l HWIO_TCU_APPS_SMMU_CB6_TLBIIPAS2L_LOW_2_APPS_ADDR A:0x61e16638
y.create.l HWIO_TCU_APPS_SMMU_CB7_TLBIIPAS2L_LOW_2_APPS_ADDR A:0x61e17638
y.create.l HWIO_TCU_APPS_SMMU_CB8_TLBIIPAS2L_LOW_2_APPS_ADDR A:0x61e18638
y.create.l HWIO_TCU_APPS_SMMU_CB9_TLBIIPAS2L_LOW_2_APPS_ADDR A:0x61e19638
y.create.l HWIO_TCU_APPS_SMMU_CB10_TLBIIPAS2L_LOW_2_APPS_ADDR A:0x61e1a638
y.create.l HWIO_TCU_APPS_SMMU_CB11_TLBIIPAS2L_LOW_2_APPS_ADDR A:0x61e1b638
y.create.l HWIO_TCU_APPS_SMMU_CB12_TLBIIPAS2L_LOW_2_APPS_ADDR A:0x61e1c638
y.create.l HWIO_TCU_APPS_SMMU_CB13_TLBIIPAS2L_LOW_2_APPS_ADDR A:0x61e1d638
y.create.l HWIO_TCU_APPS_SMMU_CB14_TLBIIPAS2L_LOW_2_APPS_ADDR A:0x61e1e638
y.create.l HWIO_TCU_APPS_SMMU_CB15_TLBIIPAS2L_LOW_2_APPS_ADDR A:0x61e1f638
y.create.l HWIO_TCU_APPS_SMMU_CB0_TLBIIPAS2L_HIGH_2_APPS_ADDR A:0x61e1063c
y.create.l HWIO_TCU_APPS_SMMU_CB1_TLBIIPAS2L_HIGH_2_APPS_ADDR A:0x61e1163c
y.create.l HWIO_TCU_APPS_SMMU_CB2_TLBIIPAS2L_HIGH_2_APPS_ADDR A:0x61e1263c
y.create.l HWIO_TCU_APPS_SMMU_CB3_TLBIIPAS2L_HIGH_2_APPS_ADDR A:0x61e1363c
y.create.l HWIO_TCU_APPS_SMMU_CB4_TLBIIPAS2L_HIGH_2_APPS_ADDR A:0x61e1463c
y.create.l HWIO_TCU_APPS_SMMU_CB5_TLBIIPAS2L_HIGH_2_APPS_ADDR A:0x61e1563c
y.create.l HWIO_TCU_APPS_SMMU_CB6_TLBIIPAS2L_HIGH_2_APPS_ADDR A:0x61e1663c
y.create.l HWIO_TCU_APPS_SMMU_CB7_TLBIIPAS2L_HIGH_2_APPS_ADDR A:0x61e1763c
y.create.l HWIO_TCU_APPS_SMMU_CB8_TLBIIPAS2L_HIGH_2_APPS_ADDR A:0x61e1863c
y.create.l HWIO_TCU_APPS_SMMU_CB9_TLBIIPAS2L_HIGH_2_APPS_ADDR A:0x61e1963c
y.create.l HWIO_TCU_APPS_SMMU_CB10_TLBIIPAS2L_HIGH_2_APPS_ADDR A:0x61e1a63c
y.create.l HWIO_TCU_APPS_SMMU_CB11_TLBIIPAS2L_HIGH_2_APPS_ADDR A:0x61e1b63c
y.create.l HWIO_TCU_APPS_SMMU_CB12_TLBIIPAS2L_HIGH_2_APPS_ADDR A:0x61e1c63c
y.create.l HWIO_TCU_APPS_SMMU_CB13_TLBIIPAS2L_HIGH_2_APPS_ADDR A:0x61e1d63c
y.create.l HWIO_TCU_APPS_SMMU_CB14_TLBIIPAS2L_HIGH_2_APPS_ADDR A:0x61e1e63c
y.create.l HWIO_TCU_APPS_SMMU_CB15_TLBIIPAS2L_HIGH_2_APPS_ADDR A:0x61e1f63c
y.create.l HWIO_TCU_APPS_SMMU_CB0_TLBSYNC_2_APPS_ADDR A:0x61e107f0
y.create.l HWIO_TCU_APPS_SMMU_CB1_TLBSYNC_2_APPS_ADDR A:0x61e117f0
y.create.l HWIO_TCU_APPS_SMMU_CB2_TLBSYNC_2_APPS_ADDR A:0x61e127f0
y.create.l HWIO_TCU_APPS_SMMU_CB3_TLBSYNC_2_APPS_ADDR A:0x61e137f0
y.create.l HWIO_TCU_APPS_SMMU_CB4_TLBSYNC_2_APPS_ADDR A:0x61e147f0
y.create.l HWIO_TCU_APPS_SMMU_CB5_TLBSYNC_2_APPS_ADDR A:0x61e157f0
y.create.l HWIO_TCU_APPS_SMMU_CB6_TLBSYNC_2_APPS_ADDR A:0x61e167f0
y.create.l HWIO_TCU_APPS_SMMU_CB7_TLBSYNC_2_APPS_ADDR A:0x61e177f0
y.create.l HWIO_TCU_APPS_SMMU_CB8_TLBSYNC_2_APPS_ADDR A:0x61e187f0
y.create.l HWIO_TCU_APPS_SMMU_CB9_TLBSYNC_2_APPS_ADDR A:0x61e197f0
y.create.l HWIO_TCU_APPS_SMMU_CB10_TLBSYNC_2_APPS_ADDR A:0x61e1a7f0
y.create.l HWIO_TCU_APPS_SMMU_CB11_TLBSYNC_2_APPS_ADDR A:0x61e1b7f0
y.create.l HWIO_TCU_APPS_SMMU_CB12_TLBSYNC_2_APPS_ADDR A:0x61e1c7f0
y.create.l HWIO_TCU_APPS_SMMU_CB13_TLBSYNC_2_APPS_ADDR A:0x61e1d7f0
y.create.l HWIO_TCU_APPS_SMMU_CB14_TLBSYNC_2_APPS_ADDR A:0x61e1e7f0
y.create.l HWIO_TCU_APPS_SMMU_CB15_TLBSYNC_2_APPS_ADDR A:0x61e1f7f0
y.create.l HWIO_TCU_APPS_SMMU_CB0_TLBSTATUS_2_APPS_ADDR A:0x61e107f4
y.create.l HWIO_TCU_APPS_SMMU_CB1_TLBSTATUS_2_APPS_ADDR A:0x61e117f4
y.create.l HWIO_TCU_APPS_SMMU_CB2_TLBSTATUS_2_APPS_ADDR A:0x61e127f4
y.create.l HWIO_TCU_APPS_SMMU_CB3_TLBSTATUS_2_APPS_ADDR A:0x61e137f4
y.create.l HWIO_TCU_APPS_SMMU_CB4_TLBSTATUS_2_APPS_ADDR A:0x61e147f4
y.create.l HWIO_TCU_APPS_SMMU_CB5_TLBSTATUS_2_APPS_ADDR A:0x61e157f4
y.create.l HWIO_TCU_APPS_SMMU_CB6_TLBSTATUS_2_APPS_ADDR A:0x61e167f4
y.create.l HWIO_TCU_APPS_SMMU_CB7_TLBSTATUS_2_APPS_ADDR A:0x61e177f4
y.create.l HWIO_TCU_APPS_SMMU_CB8_TLBSTATUS_2_APPS_ADDR A:0x61e187f4
y.create.l HWIO_TCU_APPS_SMMU_CB9_TLBSTATUS_2_APPS_ADDR A:0x61e197f4
y.create.l HWIO_TCU_APPS_SMMU_CB10_TLBSTATUS_2_APPS_ADDR A:0x61e1a7f4
y.create.l HWIO_TCU_APPS_SMMU_CB11_TLBSTATUS_2_APPS_ADDR A:0x61e1b7f4
y.create.l HWIO_TCU_APPS_SMMU_CB12_TLBSTATUS_2_APPS_ADDR A:0x61e1c7f4
y.create.l HWIO_TCU_APPS_SMMU_CB13_TLBSTATUS_2_APPS_ADDR A:0x61e1d7f4
y.create.l HWIO_TCU_APPS_SMMU_CB14_TLBSTATUS_2_APPS_ADDR A:0x61e1e7f4
y.create.l HWIO_TCU_APPS_SMMU_CB15_TLBSTATUS_2_APPS_ADDR A:0x61e1f7f4
y.create.l HWIO_TCU_APPS_SMMU_CB0_PMEVCNTR0_2_APPS_ADDR A:0x61e10e00
y.create.l HWIO_TCU_APPS_SMMU_CB1_PMEVCNTR0_2_APPS_ADDR A:0x61e11e00
y.create.l HWIO_TCU_APPS_SMMU_CB2_PMEVCNTR0_2_APPS_ADDR A:0x61e12e00
y.create.l HWIO_TCU_APPS_SMMU_CB3_PMEVCNTR0_2_APPS_ADDR A:0x61e13e00
y.create.l HWIO_TCU_APPS_SMMU_CB4_PMEVCNTR0_2_APPS_ADDR A:0x61e14e00
y.create.l HWIO_TCU_APPS_SMMU_CB5_PMEVCNTR0_2_APPS_ADDR A:0x61e15e00
y.create.l HWIO_TCU_APPS_SMMU_CB6_PMEVCNTR0_2_APPS_ADDR A:0x61e16e00
y.create.l HWIO_TCU_APPS_SMMU_CB7_PMEVCNTR0_2_APPS_ADDR A:0x61e17e00
y.create.l HWIO_TCU_APPS_SMMU_CB8_PMEVCNTR0_2_APPS_ADDR A:0x61e18e00
y.create.l HWIO_TCU_APPS_SMMU_CB9_PMEVCNTR0_2_APPS_ADDR A:0x61e19e00
y.create.l HWIO_TCU_APPS_SMMU_CB10_PMEVCNTR0_2_APPS_ADDR A:0x61e1ae00
y.create.l HWIO_TCU_APPS_SMMU_CB11_PMEVCNTR0_2_APPS_ADDR A:0x61e1be00
y.create.l HWIO_TCU_APPS_SMMU_CB12_PMEVCNTR0_2_APPS_ADDR A:0x61e1ce00
y.create.l HWIO_TCU_APPS_SMMU_CB13_PMEVCNTR0_2_APPS_ADDR A:0x61e1de00
y.create.l HWIO_TCU_APPS_SMMU_CB14_PMEVCNTR0_2_APPS_ADDR A:0x61e1ee00
y.create.l HWIO_TCU_APPS_SMMU_CB15_PMEVCNTR0_2_APPS_ADDR A:0x61e1fe00
y.create.l HWIO_TCU_APPS_SMMU_CB0_PMEVCNTR1_2_APPS_ADDR A:0x61e10e04
y.create.l HWIO_TCU_APPS_SMMU_CB1_PMEVCNTR1_2_APPS_ADDR A:0x61e11e04
y.create.l HWIO_TCU_APPS_SMMU_CB2_PMEVCNTR1_2_APPS_ADDR A:0x61e12e04
y.create.l HWIO_TCU_APPS_SMMU_CB3_PMEVCNTR1_2_APPS_ADDR A:0x61e13e04
y.create.l HWIO_TCU_APPS_SMMU_CB4_PMEVCNTR1_2_APPS_ADDR A:0x61e14e04
y.create.l HWIO_TCU_APPS_SMMU_CB5_PMEVCNTR1_2_APPS_ADDR A:0x61e15e04
y.create.l HWIO_TCU_APPS_SMMU_CB6_PMEVCNTR1_2_APPS_ADDR A:0x61e16e04
y.create.l HWIO_TCU_APPS_SMMU_CB7_PMEVCNTR1_2_APPS_ADDR A:0x61e17e04
y.create.l HWIO_TCU_APPS_SMMU_CB8_PMEVCNTR1_2_APPS_ADDR A:0x61e18e04
y.create.l HWIO_TCU_APPS_SMMU_CB9_PMEVCNTR1_2_APPS_ADDR A:0x61e19e04
y.create.l HWIO_TCU_APPS_SMMU_CB10_PMEVCNTR1_2_APPS_ADDR A:0x61e1ae04
y.create.l HWIO_TCU_APPS_SMMU_CB11_PMEVCNTR1_2_APPS_ADDR A:0x61e1be04
y.create.l HWIO_TCU_APPS_SMMU_CB12_PMEVCNTR1_2_APPS_ADDR A:0x61e1ce04
y.create.l HWIO_TCU_APPS_SMMU_CB13_PMEVCNTR1_2_APPS_ADDR A:0x61e1de04
y.create.l HWIO_TCU_APPS_SMMU_CB14_PMEVCNTR1_2_APPS_ADDR A:0x61e1ee04
y.create.l HWIO_TCU_APPS_SMMU_CB15_PMEVCNTR1_2_APPS_ADDR A:0x61e1fe04
y.create.l HWIO_TCU_APPS_SMMU_CB0_PMEVCNTR2_2_APPS_ADDR A:0x61e10e08
y.create.l HWIO_TCU_APPS_SMMU_CB1_PMEVCNTR2_2_APPS_ADDR A:0x61e11e08
y.create.l HWIO_TCU_APPS_SMMU_CB2_PMEVCNTR2_2_APPS_ADDR A:0x61e12e08
y.create.l HWIO_TCU_APPS_SMMU_CB3_PMEVCNTR2_2_APPS_ADDR A:0x61e13e08
y.create.l HWIO_TCU_APPS_SMMU_CB4_PMEVCNTR2_2_APPS_ADDR A:0x61e14e08
y.create.l HWIO_TCU_APPS_SMMU_CB5_PMEVCNTR2_2_APPS_ADDR A:0x61e15e08
y.create.l HWIO_TCU_APPS_SMMU_CB6_PMEVCNTR2_2_APPS_ADDR A:0x61e16e08
y.create.l HWIO_TCU_APPS_SMMU_CB7_PMEVCNTR2_2_APPS_ADDR A:0x61e17e08
y.create.l HWIO_TCU_APPS_SMMU_CB8_PMEVCNTR2_2_APPS_ADDR A:0x61e18e08
y.create.l HWIO_TCU_APPS_SMMU_CB9_PMEVCNTR2_2_APPS_ADDR A:0x61e19e08
y.create.l HWIO_TCU_APPS_SMMU_CB10_PMEVCNTR2_2_APPS_ADDR A:0x61e1ae08
y.create.l HWIO_TCU_APPS_SMMU_CB11_PMEVCNTR2_2_APPS_ADDR A:0x61e1be08
y.create.l HWIO_TCU_APPS_SMMU_CB12_PMEVCNTR2_2_APPS_ADDR A:0x61e1ce08
y.create.l HWIO_TCU_APPS_SMMU_CB13_PMEVCNTR2_2_APPS_ADDR A:0x61e1de08
y.create.l HWIO_TCU_APPS_SMMU_CB14_PMEVCNTR2_2_APPS_ADDR A:0x61e1ee08
y.create.l HWIO_TCU_APPS_SMMU_CB15_PMEVCNTR2_2_APPS_ADDR A:0x61e1fe08
y.create.l HWIO_TCU_APPS_SMMU_CB0_PMEVCNTR3_2_APPS_ADDR A:0x61e10e0c
y.create.l HWIO_TCU_APPS_SMMU_CB1_PMEVCNTR3_2_APPS_ADDR A:0x61e11e0c
y.create.l HWIO_TCU_APPS_SMMU_CB2_PMEVCNTR3_2_APPS_ADDR A:0x61e12e0c
y.create.l HWIO_TCU_APPS_SMMU_CB3_PMEVCNTR3_2_APPS_ADDR A:0x61e13e0c
y.create.l HWIO_TCU_APPS_SMMU_CB4_PMEVCNTR3_2_APPS_ADDR A:0x61e14e0c
y.create.l HWIO_TCU_APPS_SMMU_CB5_PMEVCNTR3_2_APPS_ADDR A:0x61e15e0c
y.create.l HWIO_TCU_APPS_SMMU_CB6_PMEVCNTR3_2_APPS_ADDR A:0x61e16e0c
y.create.l HWIO_TCU_APPS_SMMU_CB7_PMEVCNTR3_2_APPS_ADDR A:0x61e17e0c
y.create.l HWIO_TCU_APPS_SMMU_CB8_PMEVCNTR3_2_APPS_ADDR A:0x61e18e0c
y.create.l HWIO_TCU_APPS_SMMU_CB9_PMEVCNTR3_2_APPS_ADDR A:0x61e19e0c
y.create.l HWIO_TCU_APPS_SMMU_CB10_PMEVCNTR3_2_APPS_ADDR A:0x61e1ae0c
y.create.l HWIO_TCU_APPS_SMMU_CB11_PMEVCNTR3_2_APPS_ADDR A:0x61e1be0c
y.create.l HWIO_TCU_APPS_SMMU_CB12_PMEVCNTR3_2_APPS_ADDR A:0x61e1ce0c
y.create.l HWIO_TCU_APPS_SMMU_CB13_PMEVCNTR3_2_APPS_ADDR A:0x61e1de0c
y.create.l HWIO_TCU_APPS_SMMU_CB14_PMEVCNTR3_2_APPS_ADDR A:0x61e1ee0c
y.create.l HWIO_TCU_APPS_SMMU_CB15_PMEVCNTR3_2_APPS_ADDR A:0x61e1fe0c
y.create.l HWIO_TCU_APPS_SMMU_CB0_PMEVTYPER0_2_APPS_ADDR A:0x61e10e80
y.create.l HWIO_TCU_APPS_SMMU_CB1_PMEVTYPER0_2_APPS_ADDR A:0x61e11e80
y.create.l HWIO_TCU_APPS_SMMU_CB2_PMEVTYPER0_2_APPS_ADDR A:0x61e12e80
y.create.l HWIO_TCU_APPS_SMMU_CB3_PMEVTYPER0_2_APPS_ADDR A:0x61e13e80
y.create.l HWIO_TCU_APPS_SMMU_CB4_PMEVTYPER0_2_APPS_ADDR A:0x61e14e80
y.create.l HWIO_TCU_APPS_SMMU_CB5_PMEVTYPER0_2_APPS_ADDR A:0x61e15e80
y.create.l HWIO_TCU_APPS_SMMU_CB6_PMEVTYPER0_2_APPS_ADDR A:0x61e16e80
y.create.l HWIO_TCU_APPS_SMMU_CB7_PMEVTYPER0_2_APPS_ADDR A:0x61e17e80
y.create.l HWIO_TCU_APPS_SMMU_CB8_PMEVTYPER0_2_APPS_ADDR A:0x61e18e80
y.create.l HWIO_TCU_APPS_SMMU_CB9_PMEVTYPER0_2_APPS_ADDR A:0x61e19e80
y.create.l HWIO_TCU_APPS_SMMU_CB10_PMEVTYPER0_2_APPS_ADDR A:0x61e1ae80
y.create.l HWIO_TCU_APPS_SMMU_CB11_PMEVTYPER0_2_APPS_ADDR A:0x61e1be80
y.create.l HWIO_TCU_APPS_SMMU_CB12_PMEVTYPER0_2_APPS_ADDR A:0x61e1ce80
y.create.l HWIO_TCU_APPS_SMMU_CB13_PMEVTYPER0_2_APPS_ADDR A:0x61e1de80
y.create.l HWIO_TCU_APPS_SMMU_CB14_PMEVTYPER0_2_APPS_ADDR A:0x61e1ee80
y.create.l HWIO_TCU_APPS_SMMU_CB15_PMEVTYPER0_2_APPS_ADDR A:0x61e1fe80
y.create.l HWIO_TCU_APPS_SMMU_CB0_PMEVTYPER1_2_APPS_ADDR A:0x61e10e84
y.create.l HWIO_TCU_APPS_SMMU_CB1_PMEVTYPER1_2_APPS_ADDR A:0x61e11e84
y.create.l HWIO_TCU_APPS_SMMU_CB2_PMEVTYPER1_2_APPS_ADDR A:0x61e12e84
y.create.l HWIO_TCU_APPS_SMMU_CB3_PMEVTYPER1_2_APPS_ADDR A:0x61e13e84
y.create.l HWIO_TCU_APPS_SMMU_CB4_PMEVTYPER1_2_APPS_ADDR A:0x61e14e84
y.create.l HWIO_TCU_APPS_SMMU_CB5_PMEVTYPER1_2_APPS_ADDR A:0x61e15e84
y.create.l HWIO_TCU_APPS_SMMU_CB6_PMEVTYPER1_2_APPS_ADDR A:0x61e16e84
y.create.l HWIO_TCU_APPS_SMMU_CB7_PMEVTYPER1_2_APPS_ADDR A:0x61e17e84
y.create.l HWIO_TCU_APPS_SMMU_CB8_PMEVTYPER1_2_APPS_ADDR A:0x61e18e84
y.create.l HWIO_TCU_APPS_SMMU_CB9_PMEVTYPER1_2_APPS_ADDR A:0x61e19e84
y.create.l HWIO_TCU_APPS_SMMU_CB10_PMEVTYPER1_2_APPS_ADDR A:0x61e1ae84
y.create.l HWIO_TCU_APPS_SMMU_CB11_PMEVTYPER1_2_APPS_ADDR A:0x61e1be84
y.create.l HWIO_TCU_APPS_SMMU_CB12_PMEVTYPER1_2_APPS_ADDR A:0x61e1ce84
y.create.l HWIO_TCU_APPS_SMMU_CB13_PMEVTYPER1_2_APPS_ADDR A:0x61e1de84
y.create.l HWIO_TCU_APPS_SMMU_CB14_PMEVTYPER1_2_APPS_ADDR A:0x61e1ee84
y.create.l HWIO_TCU_APPS_SMMU_CB15_PMEVTYPER1_2_APPS_ADDR A:0x61e1fe84
y.create.l HWIO_TCU_APPS_SMMU_CB0_PMEVTYPER2_2_APPS_ADDR A:0x61e10e88
y.create.l HWIO_TCU_APPS_SMMU_CB1_PMEVTYPER2_2_APPS_ADDR A:0x61e11e88
y.create.l HWIO_TCU_APPS_SMMU_CB2_PMEVTYPER2_2_APPS_ADDR A:0x61e12e88
y.create.l HWIO_TCU_APPS_SMMU_CB3_PMEVTYPER2_2_APPS_ADDR A:0x61e13e88
y.create.l HWIO_TCU_APPS_SMMU_CB4_PMEVTYPER2_2_APPS_ADDR A:0x61e14e88
y.create.l HWIO_TCU_APPS_SMMU_CB5_PMEVTYPER2_2_APPS_ADDR A:0x61e15e88
y.create.l HWIO_TCU_APPS_SMMU_CB6_PMEVTYPER2_2_APPS_ADDR A:0x61e16e88
y.create.l HWIO_TCU_APPS_SMMU_CB7_PMEVTYPER2_2_APPS_ADDR A:0x61e17e88
y.create.l HWIO_TCU_APPS_SMMU_CB8_PMEVTYPER2_2_APPS_ADDR A:0x61e18e88
y.create.l HWIO_TCU_APPS_SMMU_CB9_PMEVTYPER2_2_APPS_ADDR A:0x61e19e88
y.create.l HWIO_TCU_APPS_SMMU_CB10_PMEVTYPER2_2_APPS_ADDR A:0x61e1ae88
y.create.l HWIO_TCU_APPS_SMMU_CB11_PMEVTYPER2_2_APPS_ADDR A:0x61e1be88
y.create.l HWIO_TCU_APPS_SMMU_CB12_PMEVTYPER2_2_APPS_ADDR A:0x61e1ce88
y.create.l HWIO_TCU_APPS_SMMU_CB13_PMEVTYPER2_2_APPS_ADDR A:0x61e1de88
y.create.l HWIO_TCU_APPS_SMMU_CB14_PMEVTYPER2_2_APPS_ADDR A:0x61e1ee88
y.create.l HWIO_TCU_APPS_SMMU_CB15_PMEVTYPER2_2_APPS_ADDR A:0x61e1fe88
y.create.l HWIO_TCU_APPS_SMMU_CB0_PMEVTYPER3_2_APPS_ADDR A:0x61e10e8c
y.create.l HWIO_TCU_APPS_SMMU_CB1_PMEVTYPER3_2_APPS_ADDR A:0x61e11e8c
y.create.l HWIO_TCU_APPS_SMMU_CB2_PMEVTYPER3_2_APPS_ADDR A:0x61e12e8c
y.create.l HWIO_TCU_APPS_SMMU_CB3_PMEVTYPER3_2_APPS_ADDR A:0x61e13e8c
y.create.l HWIO_TCU_APPS_SMMU_CB4_PMEVTYPER3_2_APPS_ADDR A:0x61e14e8c
y.create.l HWIO_TCU_APPS_SMMU_CB5_PMEVTYPER3_2_APPS_ADDR A:0x61e15e8c
y.create.l HWIO_TCU_APPS_SMMU_CB6_PMEVTYPER3_2_APPS_ADDR A:0x61e16e8c
y.create.l HWIO_TCU_APPS_SMMU_CB7_PMEVTYPER3_2_APPS_ADDR A:0x61e17e8c
y.create.l HWIO_TCU_APPS_SMMU_CB8_PMEVTYPER3_2_APPS_ADDR A:0x61e18e8c
y.create.l HWIO_TCU_APPS_SMMU_CB9_PMEVTYPER3_2_APPS_ADDR A:0x61e19e8c
y.create.l HWIO_TCU_APPS_SMMU_CB10_PMEVTYPER3_2_APPS_ADDR A:0x61e1ae8c
y.create.l HWIO_TCU_APPS_SMMU_CB11_PMEVTYPER3_2_APPS_ADDR A:0x61e1be8c
y.create.l HWIO_TCU_APPS_SMMU_CB12_PMEVTYPER3_2_APPS_ADDR A:0x61e1ce8c
y.create.l HWIO_TCU_APPS_SMMU_CB13_PMEVTYPER3_2_APPS_ADDR A:0x61e1de8c
y.create.l HWIO_TCU_APPS_SMMU_CB14_PMEVTYPER3_2_APPS_ADDR A:0x61e1ee8c
y.create.l HWIO_TCU_APPS_SMMU_CB15_PMEVTYPER3_2_APPS_ADDR A:0x61e1fe8c
y.create.l HWIO_TCU_APPS_SMMU_CB0_PMCFGR_2_APPS_ADDR A:0x61e10f00
y.create.l HWIO_TCU_APPS_SMMU_CB1_PMCFGR_2_APPS_ADDR A:0x61e11f00
y.create.l HWIO_TCU_APPS_SMMU_CB2_PMCFGR_2_APPS_ADDR A:0x61e12f00
y.create.l HWIO_TCU_APPS_SMMU_CB3_PMCFGR_2_APPS_ADDR A:0x61e13f00
y.create.l HWIO_TCU_APPS_SMMU_CB4_PMCFGR_2_APPS_ADDR A:0x61e14f00
y.create.l HWIO_TCU_APPS_SMMU_CB5_PMCFGR_2_APPS_ADDR A:0x61e15f00
y.create.l HWIO_TCU_APPS_SMMU_CB6_PMCFGR_2_APPS_ADDR A:0x61e16f00
y.create.l HWIO_TCU_APPS_SMMU_CB7_PMCFGR_2_APPS_ADDR A:0x61e17f00
y.create.l HWIO_TCU_APPS_SMMU_CB8_PMCFGR_2_APPS_ADDR A:0x61e18f00
y.create.l HWIO_TCU_APPS_SMMU_CB9_PMCFGR_2_APPS_ADDR A:0x61e19f00
y.create.l HWIO_TCU_APPS_SMMU_CB10_PMCFGR_2_APPS_ADDR A:0x61e1af00
y.create.l HWIO_TCU_APPS_SMMU_CB11_PMCFGR_2_APPS_ADDR A:0x61e1bf00
y.create.l HWIO_TCU_APPS_SMMU_CB12_PMCFGR_2_APPS_ADDR A:0x61e1cf00
y.create.l HWIO_TCU_APPS_SMMU_CB13_PMCFGR_2_APPS_ADDR A:0x61e1df00
y.create.l HWIO_TCU_APPS_SMMU_CB14_PMCFGR_2_APPS_ADDR A:0x61e1ef00
y.create.l HWIO_TCU_APPS_SMMU_CB15_PMCFGR_2_APPS_ADDR A:0x61e1ff00
y.create.l HWIO_TCU_APPS_SMMU_CB0_PMCR_2_APPS_ADDR A:0x61e10f04
y.create.l HWIO_TCU_APPS_SMMU_CB1_PMCR_2_APPS_ADDR A:0x61e11f04
y.create.l HWIO_TCU_APPS_SMMU_CB2_PMCR_2_APPS_ADDR A:0x61e12f04
y.create.l HWIO_TCU_APPS_SMMU_CB3_PMCR_2_APPS_ADDR A:0x61e13f04
y.create.l HWIO_TCU_APPS_SMMU_CB4_PMCR_2_APPS_ADDR A:0x61e14f04
y.create.l HWIO_TCU_APPS_SMMU_CB5_PMCR_2_APPS_ADDR A:0x61e15f04
y.create.l HWIO_TCU_APPS_SMMU_CB6_PMCR_2_APPS_ADDR A:0x61e16f04
y.create.l HWIO_TCU_APPS_SMMU_CB7_PMCR_2_APPS_ADDR A:0x61e17f04
y.create.l HWIO_TCU_APPS_SMMU_CB8_PMCR_2_APPS_ADDR A:0x61e18f04
y.create.l HWIO_TCU_APPS_SMMU_CB9_PMCR_2_APPS_ADDR A:0x61e19f04
y.create.l HWIO_TCU_APPS_SMMU_CB10_PMCR_2_APPS_ADDR A:0x61e1af04
y.create.l HWIO_TCU_APPS_SMMU_CB11_PMCR_2_APPS_ADDR A:0x61e1bf04
y.create.l HWIO_TCU_APPS_SMMU_CB12_PMCR_2_APPS_ADDR A:0x61e1cf04
y.create.l HWIO_TCU_APPS_SMMU_CB13_PMCR_2_APPS_ADDR A:0x61e1df04
y.create.l HWIO_TCU_APPS_SMMU_CB14_PMCR_2_APPS_ADDR A:0x61e1ef04
y.create.l HWIO_TCU_APPS_SMMU_CB15_PMCR_2_APPS_ADDR A:0x61e1ff04
y.create.l HWIO_TCU_APPS_SMMU_CB0_PMCEID_2_APPS_ADDR A:0x61e10f20
y.create.l HWIO_TCU_APPS_SMMU_CB1_PMCEID_2_APPS_ADDR A:0x61e11f20
y.create.l HWIO_TCU_APPS_SMMU_CB2_PMCEID_2_APPS_ADDR A:0x61e12f20
y.create.l HWIO_TCU_APPS_SMMU_CB3_PMCEID_2_APPS_ADDR A:0x61e13f20
y.create.l HWIO_TCU_APPS_SMMU_CB4_PMCEID_2_APPS_ADDR A:0x61e14f20
y.create.l HWIO_TCU_APPS_SMMU_CB5_PMCEID_2_APPS_ADDR A:0x61e15f20
y.create.l HWIO_TCU_APPS_SMMU_CB6_PMCEID_2_APPS_ADDR A:0x61e16f20
y.create.l HWIO_TCU_APPS_SMMU_CB7_PMCEID_2_APPS_ADDR A:0x61e17f20
y.create.l HWIO_TCU_APPS_SMMU_CB8_PMCEID_2_APPS_ADDR A:0x61e18f20
y.create.l HWIO_TCU_APPS_SMMU_CB9_PMCEID_2_APPS_ADDR A:0x61e19f20
y.create.l HWIO_TCU_APPS_SMMU_CB10_PMCEID_2_APPS_ADDR A:0x61e1af20
y.create.l HWIO_TCU_APPS_SMMU_CB11_PMCEID_2_APPS_ADDR A:0x61e1bf20
y.create.l HWIO_TCU_APPS_SMMU_CB12_PMCEID_2_APPS_ADDR A:0x61e1cf20
y.create.l HWIO_TCU_APPS_SMMU_CB13_PMCEID_2_APPS_ADDR A:0x61e1df20
y.create.l HWIO_TCU_APPS_SMMU_CB14_PMCEID_2_APPS_ADDR A:0x61e1ef20
y.create.l HWIO_TCU_APPS_SMMU_CB15_PMCEID_2_APPS_ADDR A:0x61e1ff20
y.create.l HWIO_TCU_APPS_SMMU_CB0_PMCNTENSE_2_APPS_ADDR A:0x61e10f40
y.create.l HWIO_TCU_APPS_SMMU_CB1_PMCNTENSE_2_APPS_ADDR A:0x61e11f40
y.create.l HWIO_TCU_APPS_SMMU_CB2_PMCNTENSE_2_APPS_ADDR A:0x61e12f40
y.create.l HWIO_TCU_APPS_SMMU_CB3_PMCNTENSE_2_APPS_ADDR A:0x61e13f40
y.create.l HWIO_TCU_APPS_SMMU_CB4_PMCNTENSE_2_APPS_ADDR A:0x61e14f40
y.create.l HWIO_TCU_APPS_SMMU_CB5_PMCNTENSE_2_APPS_ADDR A:0x61e15f40
y.create.l HWIO_TCU_APPS_SMMU_CB6_PMCNTENSE_2_APPS_ADDR A:0x61e16f40
y.create.l HWIO_TCU_APPS_SMMU_CB7_PMCNTENSE_2_APPS_ADDR A:0x61e17f40
y.create.l HWIO_TCU_APPS_SMMU_CB8_PMCNTENSE_2_APPS_ADDR A:0x61e18f40
y.create.l HWIO_TCU_APPS_SMMU_CB9_PMCNTENSE_2_APPS_ADDR A:0x61e19f40
y.create.l HWIO_TCU_APPS_SMMU_CB10_PMCNTENSE_2_APPS_ADDR A:0x61e1af40
y.create.l HWIO_TCU_APPS_SMMU_CB11_PMCNTENSE_2_APPS_ADDR A:0x61e1bf40
y.create.l HWIO_TCU_APPS_SMMU_CB12_PMCNTENSE_2_APPS_ADDR A:0x61e1cf40
y.create.l HWIO_TCU_APPS_SMMU_CB13_PMCNTENSE_2_APPS_ADDR A:0x61e1df40
y.create.l HWIO_TCU_APPS_SMMU_CB14_PMCNTENSE_2_APPS_ADDR A:0x61e1ef40
y.create.l HWIO_TCU_APPS_SMMU_CB15_PMCNTENSE_2_APPS_ADDR A:0x61e1ff40
y.create.l HWIO_TCU_APPS_SMMU_CB0_PMCNTENCLR_2_APPS_ADDR A:0x61e10f44
y.create.l HWIO_TCU_APPS_SMMU_CB1_PMCNTENCLR_2_APPS_ADDR A:0x61e11f44
y.create.l HWIO_TCU_APPS_SMMU_CB2_PMCNTENCLR_2_APPS_ADDR A:0x61e12f44
y.create.l HWIO_TCU_APPS_SMMU_CB3_PMCNTENCLR_2_APPS_ADDR A:0x61e13f44
y.create.l HWIO_TCU_APPS_SMMU_CB4_PMCNTENCLR_2_APPS_ADDR A:0x61e14f44
y.create.l HWIO_TCU_APPS_SMMU_CB5_PMCNTENCLR_2_APPS_ADDR A:0x61e15f44
y.create.l HWIO_TCU_APPS_SMMU_CB6_PMCNTENCLR_2_APPS_ADDR A:0x61e16f44
y.create.l HWIO_TCU_APPS_SMMU_CB7_PMCNTENCLR_2_APPS_ADDR A:0x61e17f44
y.create.l HWIO_TCU_APPS_SMMU_CB8_PMCNTENCLR_2_APPS_ADDR A:0x61e18f44
y.create.l HWIO_TCU_APPS_SMMU_CB9_PMCNTENCLR_2_APPS_ADDR A:0x61e19f44
y.create.l HWIO_TCU_APPS_SMMU_CB10_PMCNTENCLR_2_APPS_ADDR A:0x61e1af44
y.create.l HWIO_TCU_APPS_SMMU_CB11_PMCNTENCLR_2_APPS_ADDR A:0x61e1bf44
y.create.l HWIO_TCU_APPS_SMMU_CB12_PMCNTENCLR_2_APPS_ADDR A:0x61e1cf44
y.create.l HWIO_TCU_APPS_SMMU_CB13_PMCNTENCLR_2_APPS_ADDR A:0x61e1df44
y.create.l HWIO_TCU_APPS_SMMU_CB14_PMCNTENCLR_2_APPS_ADDR A:0x61e1ef44
y.create.l HWIO_TCU_APPS_SMMU_CB15_PMCNTENCLR_2_APPS_ADDR A:0x61e1ff44
y.create.l HWIO_TCU_APPS_SMMU_CB0_PMCNTENSET_2_APPS_ADDR A:0x61e10f48
y.create.l HWIO_TCU_APPS_SMMU_CB1_PMCNTENSET_2_APPS_ADDR A:0x61e11f48
y.create.l HWIO_TCU_APPS_SMMU_CB2_PMCNTENSET_2_APPS_ADDR A:0x61e12f48
y.create.l HWIO_TCU_APPS_SMMU_CB3_PMCNTENSET_2_APPS_ADDR A:0x61e13f48
y.create.l HWIO_TCU_APPS_SMMU_CB4_PMCNTENSET_2_APPS_ADDR A:0x61e14f48
y.create.l HWIO_TCU_APPS_SMMU_CB5_PMCNTENSET_2_APPS_ADDR A:0x61e15f48
y.create.l HWIO_TCU_APPS_SMMU_CB6_PMCNTENSET_2_APPS_ADDR A:0x61e16f48
y.create.l HWIO_TCU_APPS_SMMU_CB7_PMCNTENSET_2_APPS_ADDR A:0x61e17f48
y.create.l HWIO_TCU_APPS_SMMU_CB8_PMCNTENSET_2_APPS_ADDR A:0x61e18f48
y.create.l HWIO_TCU_APPS_SMMU_CB9_PMCNTENSET_2_APPS_ADDR A:0x61e19f48
y.create.l HWIO_TCU_APPS_SMMU_CB10_PMCNTENSET_2_APPS_ADDR A:0x61e1af48
y.create.l HWIO_TCU_APPS_SMMU_CB11_PMCNTENSET_2_APPS_ADDR A:0x61e1bf48
y.create.l HWIO_TCU_APPS_SMMU_CB12_PMCNTENSET_2_APPS_ADDR A:0x61e1cf48
y.create.l HWIO_TCU_APPS_SMMU_CB13_PMCNTENSET_2_APPS_ADDR A:0x61e1df48
y.create.l HWIO_TCU_APPS_SMMU_CB14_PMCNTENSET_2_APPS_ADDR A:0x61e1ef48
y.create.l HWIO_TCU_APPS_SMMU_CB15_PMCNTENSET_2_APPS_ADDR A:0x61e1ff48
y.create.l HWIO_TCU_APPS_SMMU_CB0_PMINTENCLR_2_APPS_ADDR A:0x61e10f4c
y.create.l HWIO_TCU_APPS_SMMU_CB1_PMINTENCLR_2_APPS_ADDR A:0x61e11f4c
y.create.l HWIO_TCU_APPS_SMMU_CB2_PMINTENCLR_2_APPS_ADDR A:0x61e12f4c
y.create.l HWIO_TCU_APPS_SMMU_CB3_PMINTENCLR_2_APPS_ADDR A:0x61e13f4c
y.create.l HWIO_TCU_APPS_SMMU_CB4_PMINTENCLR_2_APPS_ADDR A:0x61e14f4c
y.create.l HWIO_TCU_APPS_SMMU_CB5_PMINTENCLR_2_APPS_ADDR A:0x61e15f4c
y.create.l HWIO_TCU_APPS_SMMU_CB6_PMINTENCLR_2_APPS_ADDR A:0x61e16f4c
y.create.l HWIO_TCU_APPS_SMMU_CB7_PMINTENCLR_2_APPS_ADDR A:0x61e17f4c
y.create.l HWIO_TCU_APPS_SMMU_CB8_PMINTENCLR_2_APPS_ADDR A:0x61e18f4c
y.create.l HWIO_TCU_APPS_SMMU_CB9_PMINTENCLR_2_APPS_ADDR A:0x61e19f4c
y.create.l HWIO_TCU_APPS_SMMU_CB10_PMINTENCLR_2_APPS_ADDR A:0x61e1af4c
y.create.l HWIO_TCU_APPS_SMMU_CB11_PMINTENCLR_2_APPS_ADDR A:0x61e1bf4c
y.create.l HWIO_TCU_APPS_SMMU_CB12_PMINTENCLR_2_APPS_ADDR A:0x61e1cf4c
y.create.l HWIO_TCU_APPS_SMMU_CB13_PMINTENCLR_2_APPS_ADDR A:0x61e1df4c
y.create.l HWIO_TCU_APPS_SMMU_CB14_PMINTENCLR_2_APPS_ADDR A:0x61e1ef4c
y.create.l HWIO_TCU_APPS_SMMU_CB15_PMINTENCLR_2_APPS_ADDR A:0x61e1ff4c
y.create.l HWIO_TCU_APPS_SMMU_CB0_PMOVSCLR_2_APPS_ADDR A:0x61e10f50
y.create.l HWIO_TCU_APPS_SMMU_CB1_PMOVSCLR_2_APPS_ADDR A:0x61e11f50
y.create.l HWIO_TCU_APPS_SMMU_CB2_PMOVSCLR_2_APPS_ADDR A:0x61e12f50
y.create.l HWIO_TCU_APPS_SMMU_CB3_PMOVSCLR_2_APPS_ADDR A:0x61e13f50
y.create.l HWIO_TCU_APPS_SMMU_CB4_PMOVSCLR_2_APPS_ADDR A:0x61e14f50
y.create.l HWIO_TCU_APPS_SMMU_CB5_PMOVSCLR_2_APPS_ADDR A:0x61e15f50
y.create.l HWIO_TCU_APPS_SMMU_CB6_PMOVSCLR_2_APPS_ADDR A:0x61e16f50
y.create.l HWIO_TCU_APPS_SMMU_CB7_PMOVSCLR_2_APPS_ADDR A:0x61e17f50
y.create.l HWIO_TCU_APPS_SMMU_CB8_PMOVSCLR_2_APPS_ADDR A:0x61e18f50
y.create.l HWIO_TCU_APPS_SMMU_CB9_PMOVSCLR_2_APPS_ADDR A:0x61e19f50
y.create.l HWIO_TCU_APPS_SMMU_CB10_PMOVSCLR_2_APPS_ADDR A:0x61e1af50
y.create.l HWIO_TCU_APPS_SMMU_CB11_PMOVSCLR_2_APPS_ADDR A:0x61e1bf50
y.create.l HWIO_TCU_APPS_SMMU_CB12_PMOVSCLR_2_APPS_ADDR A:0x61e1cf50
y.create.l HWIO_TCU_APPS_SMMU_CB13_PMOVSCLR_2_APPS_ADDR A:0x61e1df50
y.create.l HWIO_TCU_APPS_SMMU_CB14_PMOVSCLR_2_APPS_ADDR A:0x61e1ef50
y.create.l HWIO_TCU_APPS_SMMU_CB15_PMOVSCLR_2_APPS_ADDR A:0x61e1ff50
y.create.l HWIO_TCU_APPS_SMMU_CB0_PMOVSSET_2_APPS_ADDR A:0x61e10f58
y.create.l HWIO_TCU_APPS_SMMU_CB1_PMOVSSET_2_APPS_ADDR A:0x61e11f58
y.create.l HWIO_TCU_APPS_SMMU_CB2_PMOVSSET_2_APPS_ADDR A:0x61e12f58
y.create.l HWIO_TCU_APPS_SMMU_CB3_PMOVSSET_2_APPS_ADDR A:0x61e13f58
y.create.l HWIO_TCU_APPS_SMMU_CB4_PMOVSSET_2_APPS_ADDR A:0x61e14f58
y.create.l HWIO_TCU_APPS_SMMU_CB5_PMOVSSET_2_APPS_ADDR A:0x61e15f58
y.create.l HWIO_TCU_APPS_SMMU_CB6_PMOVSSET_2_APPS_ADDR A:0x61e16f58
y.create.l HWIO_TCU_APPS_SMMU_CB7_PMOVSSET_2_APPS_ADDR A:0x61e17f58
y.create.l HWIO_TCU_APPS_SMMU_CB8_PMOVSSET_2_APPS_ADDR A:0x61e18f58
y.create.l HWIO_TCU_APPS_SMMU_CB9_PMOVSSET_2_APPS_ADDR A:0x61e19f58
y.create.l HWIO_TCU_APPS_SMMU_CB10_PMOVSSET_2_APPS_ADDR A:0x61e1af58
y.create.l HWIO_TCU_APPS_SMMU_CB11_PMOVSSET_2_APPS_ADDR A:0x61e1bf58
y.create.l HWIO_TCU_APPS_SMMU_CB12_PMOVSSET_2_APPS_ADDR A:0x61e1cf58
y.create.l HWIO_TCU_APPS_SMMU_CB13_PMOVSSET_2_APPS_ADDR A:0x61e1df58
y.create.l HWIO_TCU_APPS_SMMU_CB14_PMOVSSET_2_APPS_ADDR A:0x61e1ef58
y.create.l HWIO_TCU_APPS_SMMU_CB15_PMOVSSET_2_APPS_ADDR A:0x61e1ff58
y.create.l HWIO_TCU_APPS_SMMU_CB0_PMAUTHSTATUS_2_APPS_ADDR A:0x61e10fb8
y.create.l HWIO_TCU_APPS_SMMU_CB1_PMAUTHSTATUS_2_APPS_ADDR A:0x61e11fb8
y.create.l HWIO_TCU_APPS_SMMU_CB2_PMAUTHSTATUS_2_APPS_ADDR A:0x61e12fb8
y.create.l HWIO_TCU_APPS_SMMU_CB3_PMAUTHSTATUS_2_APPS_ADDR A:0x61e13fb8
y.create.l HWIO_TCU_APPS_SMMU_CB4_PMAUTHSTATUS_2_APPS_ADDR A:0x61e14fb8
y.create.l HWIO_TCU_APPS_SMMU_CB5_PMAUTHSTATUS_2_APPS_ADDR A:0x61e15fb8
y.create.l HWIO_TCU_APPS_SMMU_CB6_PMAUTHSTATUS_2_APPS_ADDR A:0x61e16fb8
y.create.l HWIO_TCU_APPS_SMMU_CB7_PMAUTHSTATUS_2_APPS_ADDR A:0x61e17fb8
y.create.l HWIO_TCU_APPS_SMMU_CB8_PMAUTHSTATUS_2_APPS_ADDR A:0x61e18fb8
y.create.l HWIO_TCU_APPS_SMMU_CB9_PMAUTHSTATUS_2_APPS_ADDR A:0x61e19fb8
y.create.l HWIO_TCU_APPS_SMMU_CB10_PMAUTHSTATUS_2_APPS_ADDR A:0x61e1afb8
y.create.l HWIO_TCU_APPS_SMMU_CB11_PMAUTHSTATUS_2_APPS_ADDR A:0x61e1bfb8
y.create.l HWIO_TCU_APPS_SMMU_CB12_PMAUTHSTATUS_2_APPS_ADDR A:0x61e1cfb8
y.create.l HWIO_TCU_APPS_SMMU_CB13_PMAUTHSTATUS_2_APPS_ADDR A:0x61e1dfb8
y.create.l HWIO_TCU_APPS_SMMU_CB14_PMAUTHSTATUS_2_APPS_ADDR A:0x61e1efb8
y.create.l HWIO_TCU_APPS_SMMU_CB15_PMAUTHSTATUS_2_APPS_ADDR A:0x61e1ffb8
y.create.l HWIO_TCU_SMMU_INTR_SEL_SEC_ADDR A:0x61ef0000
y.create.l HWIO_TCU_SMMU_MISC_TIE_OFF_SEC_ADDR A:0x61ef0008
y.create.l HWIO_TCU_SMMU_CATS_64_BIT_CTL_SEC_ADDR A:0x61ef0010
y.create.l HWIO_TCU_SMMU_APP_TCU_PTW_VMID_SEC_ADDR A:0x61ef0018
y.create.l HWIO_TCU_SMMU_SPARE_REG_1_SEC_ADDR A:0x61ef0020
y.create.l HWIO_TCU_SMMU_INTR_SEL_NSHYP_ADDR A:0x61ef1000
y.create.l HWIO_TCU_SMMU_MSA_BYPASS_ERR_ADDR_NSHYP_ADDR A:0x61ef1008
y.create.l HWIO_TCU_SMMU_MSA_BYPASS_INTR_EN_NSHYP_ADDR A:0x61ef1010
y.create.l HWIO_TCU_SMMU_MSA_BYPASS_INTR_STTS_NSHYP_ADDR A:0x61ef1018
y.create.l HWIO_TCU_SMMU_MSA_BYPASS_INTR_CLR_NSHYP_ADDR A:0x61ef1020
y.create.l HWIO_TCU_SMMU_INTR_SEL_NS_ADDR A:0x61ef2000
y.create.l HWIO_TCU_SMMU_TESTBUS_SEL_NS_ADDR A:0x61ef2008
y.create.l HWIO_TCU_SMMU_HW_INFO_NS_ADDR A:0x61ef2010
y.create.l HWIO_TCU_SMMU_HW_VERSION_NS_ADDR A:0x61ef2018
y.create.l HWIO_TCU_SMMU_MODEM_TBU_VA_PA_MATCH_MSA_ADDR A:0x61ef3000
y.create.l HWIO_TCU_SMMU_SID2VMID_SMR_IPA_0_ADDR A:0x61ef4000
y.create.l HWIO_TCU_SMMU_SID2VMID_SMR_IPA_1_ADDR A:0x61ef4008
y.create.l HWIO_TCU_SMMU_SID2VMID_FAULT_VMID_IPA_ADDR A:0x61ef4010
y.create.l HWIO_TCU_SMMU_SID2VMID_FAULT_INTR_EN_IPA_ADDR A:0x61ef4018
y.create.l HWIO_TCU_SMMU_SID2VMID_FAULT_INTR_STTS_IPA_ADDR A:0x61ef4020
y.create.l HWIO_TCU_SMMU_SID2VMID_FAULT_INTR_CLR_IPA_ADDR A:0x61ef4028
y.create.l HWIO_TCU_SMMU_PWR_CTRL_IPA_REQ_ADDR A:0x61ef4030
y.create.l HWIO_TCU_SMMU_PWR_CTRL_IPA_ACK_ADDR A:0x61ef4038
y.create.l HWIO_TCU_SMMU_SID2VMID_SMR_CE_0_ADDR A:0x61ef5000
y.create.l HWIO_TCU_SMMU_SID2VMID_SMR_CE_1_ADDR A:0x61ef5008
y.create.l HWIO_TCU_SMMU_SID2VMID_FAULT_VMID_CE_ADDR A:0x61ef5010
y.create.l HWIO_TCU_SMMU_SID2VMID_FAULT_INTR_EN_CE_ADDR A:0x61ef5018
y.create.l HWIO_TCU_SMMU_SID2VMID_FAULT_INTR_STTS_CE_ADDR A:0x61ef5020
y.create.l HWIO_TCU_SMMU_SID2VMID_FAULT_INTR_CLR_CE_ADDR A:0x61ef5028
y.create.l HWIO_TCU_SMMU_PWR_CTRL_CE_REQ_ADDR A:0x61ef5030
y.create.l HWIO_TCU_SMMU_PWR_CTRL_CE_ACK_ADDR A:0x61ef5038
y.create.l HWIO_TCU_SMMU_SID2VMID_SMR_PERIPH_0_ADDR A:0x61ef6000
y.create.l HWIO_TCU_SMMU_SID2VMID_SMR_PERIPH_1_ADDR A:0x61ef6008
y.create.l HWIO_TCU_SMMU_SID2VMID_SMR_PERIPH_2_ADDR A:0x61ef6010
y.create.l HWIO_TCU_SMMU_SID2VMID_SMR_PERIPH_3_ADDR A:0x61ef6018
y.create.l HWIO_TCU_SMMU_SID2VMID_SMR_PERIPH_4_ADDR A:0x61ef6020
y.create.l HWIO_TCU_SMMU_SID2VMID_SMR_PERIPH_5_ADDR A:0x61ef6028
y.create.l HWIO_TCU_SMMU_SID2VMID_SMR_PERIPH_6_ADDR A:0x61ef6030
y.create.l HWIO_TCU_SMMU_SID2VMID_SMR_PERIPH_7_ADDR A:0x61ef6038
y.create.l HWIO_TCU_SMMU_SID2VMID_SMR_PERIPH_8_ADDR A:0x61ef6040
y.create.l HWIO_TCU_SMMU_SID2VMID_SMR_PERIPH_9_ADDR A:0x61ef6048
y.create.l HWIO_TCU_SMMU_SID2VMID_FAULT_VMID_PERIPH_ADDR A:0x61ef6178
y.create.l HWIO_TCU_SMMU_SID2VMID_FAULT_INTR_EN_PERIPH_ADDR A:0x61ef6180
y.create.l HWIO_TCU_SMMU_SID2VMID_FAULT_INTR_STTS_PERIPH_ADDR A:0x61ef6188
y.create.l HWIO_TCU_SMMU_SID2VMID_FAULT_INTR_CLR_PERIPH_ADDR A:0x61ef6190
y.create.l HWIO_TCU_SMMU_PWR_CTRL_PERIPH_REQ_ADDR A:0x61ef6198
y.create.l HWIO_TCU_SMMU_PWR_CTRL_PERIPH_ACK_ADDR A:0x61ef61a0
y.create.l HWIO_TCU_SMMU_SID2VMID_SMR_DIME_0_ADDR A:0x61ef7000
y.create.l HWIO_TCU_SMMU_SID2VMID_FAULT_VMID_DIME_ADDR A:0x61ef7008
y.create.l HWIO_TCU_SMMU_SID2VMID_FAULT_INTR_EN_DIME_ADDR A:0x61ef7010
y.create.l HWIO_TCU_SMMU_SID2VMID_FAULT_INTR_STTS_DIME_ADDR A:0x61ef7018
y.create.l HWIO_TCU_SMMU_SID2VMID_FAULT_INTR_CLR_DIME_ADDR A:0x61ef7020
y.create.l HWIO_TCU_SMMU_SID2VMID_SMR_QDSP_0_ADDR A:0x61ef9000
y.create.l HWIO_TCU_SMMU_SID2VMID_SMR_QDSP_1_ADDR A:0x61ef9008
y.create.l HWIO_TCU_SMMU_SID2VMID_FAULT_VMID_QDSP_ADDR A:0x61ef9010
y.create.l HWIO_TCU_SMMU_SID2VMID_FAULT_INTR_EN_QDSP_ADDR A:0x61ef9018
y.create.l HWIO_TCU_SMMU_SID2VMID_FAULT_INTR_STTS_QDSP_ADDR A:0x61ef9020
y.create.l HWIO_TCU_SMMU_SID2VMID_FAULT_INTR_CLR_QDSP_ADDR A:0x61ef9028
y.create.l HWIO_TCU_SMMU_PWR_CTRL_QDSP_REQ_ADDR A:0x61ef9030
y.create.l HWIO_TCU_SMMU_PWR_CTRL_QDSP_ACK_ADDR A:0x61ef9038
y.create.l HWIO_TCU_SMMU_SID2VMID_SMR_PCIE_AW_0_ADDR A:0x61efa000
y.create.l HWIO_TCU_SMMU_SID2VMID_SMR_PCIE_AW_1_ADDR A:0x61efa008
y.create.l HWIO_TCU_SMMU_SID2VMID_FAULT_VMID_PCIE_AW_ADDR A:0x61efa010
y.create.l HWIO_TCU_SMMU_SID2VMID_FAULT_INTR_EN_PCIE_AW_ADDR A:0x61efa018
y.create.l HWIO_TCU_SMMU_SID2VMID_FAULT_INTR_STTS_PCIE_AW_ADDR A:0x61efa020
y.create.l HWIO_TCU_SMMU_SID2VMID_FAULT_INTR_CLR_PCIE_AW_ADDR A:0x61efa028
y.create.l HWIO_TCU_SMMU_PWR_CTRL_PCIE_REQ_ADDR A:0x61efa030
y.create.l HWIO_TCU_SMMU_PWR_CTRL_PCIE_ACK_ADDR A:0x61efa038
y.create.l HWIO_TCU_SMMU_SID2VMID_SMR_USB3_AW_0_ADDR A:0x61efb000
y.create.l HWIO_TCU_SMMU_SID2VMID_FAULT_VMID_USB3_AW_ADDR A:0x61efb008
y.create.l HWIO_TCU_SMMU_SID2VMID_FAULT_INTR_EN_USB3_AW_ADDR A:0x61efb010
y.create.l HWIO_TCU_SMMU_SID2VMID_FAULT_INTR_STTS_USB3_AW_ADDR A:0x61efb018
y.create.l HWIO_TCU_SMMU_SID2VMID_FAULT_INTR_CLR_USB3_AW_ADDR A:0x61efb020
y.create.l HWIO_TCU_SMMU_PWR_CTRL_USB3_REQ_ADDR A:0x61efb028
y.create.l HWIO_TCU_SMMU_PWR_CTRL_USB3_ACK_ADDR A:0x61efb030
y.create.l HWIO_TCU_SMMU_SID2VMID_SMR_PCIE_AR_0_ADDR A:0x61efc000
y.create.l HWIO_TCU_SMMU_SID2VMID_SMR_PCIE_AR_1_ADDR A:0x61efc008
y.create.l HWIO_TCU_SMMU_SID2VMID_FAULT_VMID_PCIE_AR_ADDR A:0x61efc010
y.create.l HWIO_TCU_SMMU_SID2VMID_FAULT_INTR_EN_PCIE_AR_ADDR A:0x61efc018
y.create.l HWIO_TCU_SMMU_SID2VMID_FAULT_INTR_STTS_PCIE_AR_ADDR A:0x61efc020
y.create.l HWIO_TCU_SMMU_SID2VMID_FAULT_INTR_CLR_PCIE_AR_ADDR A:0x61efc028
y.create.l HWIO_TCU_SMMU_SID2VMID_SMR_USB3_AR_0_ADDR A:0x61efd000
y.create.l HWIO_TCU_SMMU_SID2VMID_FAULT_VMID_USB3_AR_ADDR A:0x61efd008
y.create.l HWIO_TCU_SMMU_SID2VMID_FAULT_INTR_EN_USB3_AR_ADDR A:0x61efd010
y.create.l HWIO_TCU_SMMU_SID2VMID_FAULT_INTR_STTS_USB3_AR_ADDR A:0x61efd018
y.create.l HWIO_TCU_SMMU_SID2VMID_FAULT_INTR_CLR_USB3_AR_ADDR A:0x61efd020
y.create.l HWIO_TLMM_XPU_SCR_ADDR A:0x61300000
y.create.l HWIO_TLMM_XPU_SWDR_ADDR A:0x61300004
y.create.l HWIO_TLMM_XPU_PRTN_RACR_SSHADOW_ADDR A:0x61300008
y.create.l HWIO_TLMM_XPU_PRTN_WACR_SSHADOW_ADDR A:0x6130000c
y.create.l HWIO_TLMM_XPU_PRTN_START_SSHADOW0_ADDR A:0x61300010
y.create.l HWIO_TLMM_XPU_PRTN_END_SSHADOW0_ADDR A:0x61300018
y.create.l HWIO_TLMM_XPU_SEAR0_ADDR A:0x61300040
y.create.l HWIO_TLMM_XPU_SESR_ADDR A:0x61300048
y.create.l HWIO_TLMM_XPU_SESRRESTORE_ADDR A:0x6130004c
y.create.l HWIO_TLMM_XPU_SESYNR0_ADDR A:0x61300050
y.create.l HWIO_TLMM_XPU_SESYNR1_ADDR A:0x61300054
y.create.l HWIO_TLMM_XPU_SESYNR2_ADDR A:0x61300058
y.create.l HWIO_TLMM_XPU_MCR_ADDR A:0x61300100
y.create.l HWIO_TLMM_XPU_MEAR0_ADDR A:0x61300140
y.create.l HWIO_TLMM_XPU_MESR_ADDR A:0x61300148
y.create.l HWIO_TLMM_XPU_MESRRESTORE_ADDR A:0x6130014c
y.create.l HWIO_TLMM_XPU_MESYNR0_ADDR A:0x61300150
y.create.l HWIO_TLMM_XPU_MESYNR1_ADDR A:0x61300154
y.create.l HWIO_TLMM_XPU_MESYNR2_ADDR A:0x61300158
y.create.l HWIO_TLMM_XPU_CR_ADDR A:0x61300080
y.create.l HWIO_TLMM_XPU_PRTN_RACR_SHADOW_ADDR A:0x61300088
y.create.l HWIO_TLMM_XPU_PRTN_WACR_SHADOW_ADDR A:0x6130008c
y.create.l HWIO_TLMM_XPU_PRTN_START_SHADOW0_ADDR A:0x61300090
y.create.l HWIO_TLMM_XPU_PRTN_END_SHADOW0_ADDR A:0x61300098
y.create.l HWIO_TLMM_XPU_RPU_ACR0_ADDR A:0x613000a0
y.create.l HWIO_TLMM_XPU_EAR0_ADDR A:0x613000c0
y.create.l HWIO_TLMM_XPU_ESR_ADDR A:0x613000c8
y.create.l HWIO_TLMM_XPU_ESRRESTORE_ADDR A:0x613000cc
y.create.l HWIO_TLMM_XPU_ESYNR0_ADDR A:0x613000d0
y.create.l HWIO_TLMM_XPU_ESYNR1_ADDR A:0x613000d4
y.create.l HWIO_TLMM_XPU_ESYNR2_ADDR A:0x613000d8
y.create.l HWIO_TLMM_XPU_UMR_RACR_ADDR A:0x613000e0
y.create.l HWIO_TLMM_XPU_UMR_WACR_ADDR A:0x613000e4
y.create.l HWIO_TLMM_XPU_UMR_CNTL_ADDR A:0x613000f0
y.create.l HWIO_TLMM_XPU_IDR0_ADDR A:0x61300074
y.create.l HWIO_TLMM_XPU_IDR1_ADDR A:0x61300078
y.create.l HWIO_TLMM_XPU_REV_ADDR A:0x6130007c
y.create.l HWIO_TLMM_XPU_PRT0_RACR0_ADDR A:0x61300200
y.create.l HWIO_TLMM_XPU_PRT1_RACR0_ADDR A:0x61300280
y.create.l HWIO_TLMM_XPU_PRT2_RACR0_ADDR A:0x61300300
y.create.l HWIO_TLMM_XPU_PRT3_RACR0_ADDR A:0x61300380
y.create.l HWIO_TLMM_XPU_PRT4_RACR0_ADDR A:0x61300400
y.create.l HWIO_TLMM_XPU_PRT5_RACR0_ADDR A:0x61300480
y.create.l HWIO_TLMM_XPU_PRT6_RACR0_ADDR A:0x61300500
y.create.l HWIO_TLMM_XPU_PRT7_RACR0_ADDR A:0x61300580
y.create.l HWIO_TLMM_XPU_PRT8_RACR0_ADDR A:0x61300600
y.create.l HWIO_TLMM_XPU_PRT9_RACR0_ADDR A:0x61300680
y.create.l HWIO_TLMM_XPU_PRT0_WACR0_ADDR A:0x61300220
y.create.l HWIO_TLMM_XPU_PRT1_WACR0_ADDR A:0x613002a0
y.create.l HWIO_TLMM_XPU_PRT2_WACR0_ADDR A:0x61300320
y.create.l HWIO_TLMM_XPU_PRT3_WACR0_ADDR A:0x613003a0
y.create.l HWIO_TLMM_XPU_PRT4_WACR0_ADDR A:0x61300420
y.create.l HWIO_TLMM_XPU_PRT5_WACR0_ADDR A:0x613004a0
y.create.l HWIO_TLMM_XPU_PRT6_WACR0_ADDR A:0x61300520
y.create.l HWIO_TLMM_XPU_PRT7_WACR0_ADDR A:0x613005a0
y.create.l HWIO_TLMM_XPU_PRT8_WACR0_ADDR A:0x61300620
y.create.l HWIO_TLMM_XPU_PRT9_WACR0_ADDR A:0x613006a0
y.create.l HWIO_TLMM_XPU_PRT0_START0_ADDR A:0x61300240
y.create.l HWIO_TLMM_XPU_PRT1_START0_ADDR A:0x613002c0
y.create.l HWIO_TLMM_XPU_PRT2_START0_ADDR A:0x61300340
y.create.l HWIO_TLMM_XPU_PRT3_START0_ADDR A:0x613003c0
y.create.l HWIO_TLMM_XPU_PRT4_START0_ADDR A:0x61300440
y.create.l HWIO_TLMM_XPU_PRT5_START0_ADDR A:0x613004c0
y.create.l HWIO_TLMM_XPU_PRT6_START0_ADDR A:0x61300540
y.create.l HWIO_TLMM_XPU_PRT7_START0_ADDR A:0x613005c0
y.create.l HWIO_TLMM_XPU_PRT8_START0_ADDR A:0x61300640
y.create.l HWIO_TLMM_XPU_PRT9_START0_ADDR A:0x613006c0
y.create.l HWIO_TLMM_XPU_PRT0_END0_ADDR A:0x61300248
y.create.l HWIO_TLMM_XPU_PRT1_END0_ADDR A:0x613002c8
y.create.l HWIO_TLMM_XPU_PRT2_END0_ADDR A:0x61300348
y.create.l HWIO_TLMM_XPU_PRT3_END0_ADDR A:0x613003c8
y.create.l HWIO_TLMM_XPU_PRT4_END0_ADDR A:0x61300448
y.create.l HWIO_TLMM_XPU_PRT5_END0_ADDR A:0x613004c8
y.create.l HWIO_TLMM_XPU_PRT6_END0_ADDR A:0x61300548
y.create.l HWIO_TLMM_XPU_PRT7_END0_ADDR A:0x613005c8
y.create.l HWIO_TLMM_XPU_PRT8_END0_ADDR A:0x61300648
y.create.l HWIO_TLMM_XPU_PRT9_END0_ADDR A:0x613006c8
y.create.l HWIO_TLMM_XPU_PRT0_SCR_ADDR A:0x61300250
y.create.l HWIO_TLMM_XPU_PRT1_SCR_ADDR A:0x613002d0
y.create.l HWIO_TLMM_XPU_PRT2_SCR_ADDR A:0x61300350
y.create.l HWIO_TLMM_XPU_PRT3_SCR_ADDR A:0x613003d0
y.create.l HWIO_TLMM_XPU_PRT4_SCR_ADDR A:0x61300450
y.create.l HWIO_TLMM_XPU_PRT5_SCR_ADDR A:0x613004d0
y.create.l HWIO_TLMM_XPU_PRT6_SCR_ADDR A:0x61300550
y.create.l HWIO_TLMM_XPU_PRT7_SCR_ADDR A:0x613005d0
y.create.l HWIO_TLMM_XPU_PRT8_SCR_ADDR A:0x61300650
y.create.l HWIO_TLMM_XPU_PRT9_SCR_ADDR A:0x613006d0
y.create.l HWIO_TLMM_XPU_PRT0_MCR_ADDR A:0x61300254
y.create.l HWIO_TLMM_XPU_PRT1_MCR_ADDR A:0x613002d4
y.create.l HWIO_TLMM_XPU_PRT2_MCR_ADDR A:0x61300354
y.create.l HWIO_TLMM_XPU_PRT3_MCR_ADDR A:0x613003d4
y.create.l HWIO_TLMM_XPU_PRT4_MCR_ADDR A:0x61300454
y.create.l HWIO_TLMM_XPU_PRT5_MCR_ADDR A:0x613004d4
y.create.l HWIO_TLMM_XPU_PRT6_MCR_ADDR A:0x61300554
y.create.l HWIO_TLMM_XPU_PRT7_MCR_ADDR A:0x613005d4
y.create.l HWIO_TLMM_XPU_PRT8_MCR_ADDR A:0x61300654
y.create.l HWIO_TLMM_XPU_PRT9_MCR_ADDR A:0x613006d4
y.create.l HWIO_TLMM_XPU_PRT0_CNTL0_ADDR A:0x61300258
y.create.l HWIO_TLMM_XPU_PRT1_CNTL0_ADDR A:0x613002d8
y.create.l HWIO_TLMM_XPU_PRT2_CNTL0_ADDR A:0x61300358
y.create.l HWIO_TLMM_XPU_PRT3_CNTL0_ADDR A:0x613003d8
y.create.l HWIO_TLMM_XPU_PRT4_CNTL0_ADDR A:0x61300458
y.create.l HWIO_TLMM_XPU_PRT5_CNTL0_ADDR A:0x613004d8
y.create.l HWIO_TLMM_XPU_PRT6_CNTL0_ADDR A:0x61300558
y.create.l HWIO_TLMM_XPU_PRT7_CNTL0_ADDR A:0x613005d8
y.create.l HWIO_TLMM_XPU_PRT8_CNTL0_ADDR A:0x61300658
y.create.l HWIO_TLMM_XPU_PRT9_CNTL0_ADDR A:0x613006d8
y.create.l HWIO_TLMM_XPU_PRT0_CNTL1_ADDR A:0x6130025c
y.create.l HWIO_TLMM_XPU_PRT1_CNTL1_ADDR A:0x613002dc
y.create.l HWIO_TLMM_XPU_PRT2_CNTL1_ADDR A:0x6130035c
y.create.l HWIO_TLMM_XPU_PRT3_CNTL1_ADDR A:0x613003dc
y.create.l HWIO_TLMM_XPU_PRT4_CNTL1_ADDR A:0x6130045c
y.create.l HWIO_TLMM_XPU_PRT5_CNTL1_ADDR A:0x613004dc
y.create.l HWIO_TLMM_XPU_PRT6_CNTL1_ADDR A:0x6130055c
y.create.l HWIO_TLMM_XPU_PRT7_CNTL1_ADDR A:0x613005dc
y.create.l HWIO_TLMM_XPU_PRT8_CNTL1_ADDR A:0x6130065c
y.create.l HWIO_TLMM_XPU_PRT9_CNTL1_ADDR A:0x613006dc
y.create.l HWIO_TLMM_GPIO_CFG0_ADDR A:0x61000000
y.create.l HWIO_TLMM_GPIO_CFG1_ADDR A:0x61001000
y.create.l HWIO_TLMM_GPIO_CFG2_ADDR A:0x61002000
y.create.l HWIO_TLMM_GPIO_CFG3_ADDR A:0x61003000
y.create.l HWIO_TLMM_GPIO_CFG4_ADDR A:0x61004000
y.create.l HWIO_TLMM_GPIO_CFG5_ADDR A:0x61005000
y.create.l HWIO_TLMM_GPIO_CFG6_ADDR A:0x61006000
y.create.l HWIO_TLMM_GPIO_CFG7_ADDR A:0x61007000
y.create.l HWIO_TLMM_GPIO_CFG8_ADDR A:0x61008000
y.create.l HWIO_TLMM_GPIO_CFG9_ADDR A:0x61009000
y.create.l HWIO_TLMM_GPIO_IN_OUT0_ADDR A:0x61000004
y.create.l HWIO_TLMM_GPIO_IN_OUT1_ADDR A:0x61001004
y.create.l HWIO_TLMM_GPIO_IN_OUT2_ADDR A:0x61002004
y.create.l HWIO_TLMM_GPIO_IN_OUT3_ADDR A:0x61003004
y.create.l HWIO_TLMM_GPIO_IN_OUT4_ADDR A:0x61004004
y.create.l HWIO_TLMM_GPIO_IN_OUT5_ADDR A:0x61005004
y.create.l HWIO_TLMM_GPIO_IN_OUT6_ADDR A:0x61006004
y.create.l HWIO_TLMM_GPIO_IN_OUT7_ADDR A:0x61007004
y.create.l HWIO_TLMM_GPIO_IN_OUT8_ADDR A:0x61008004
y.create.l HWIO_TLMM_GPIO_IN_OUT9_ADDR A:0x61009004
y.create.l HWIO_TLMM_GPIO_INTR_CFG0_ADDR A:0x61000008
y.create.l HWIO_TLMM_GPIO_INTR_CFG1_ADDR A:0x61001008
y.create.l HWIO_TLMM_GPIO_INTR_CFG2_ADDR A:0x61002008
y.create.l HWIO_TLMM_GPIO_INTR_CFG3_ADDR A:0x61003008
y.create.l HWIO_TLMM_GPIO_INTR_CFG4_ADDR A:0x61004008
y.create.l HWIO_TLMM_GPIO_INTR_CFG5_ADDR A:0x61005008
y.create.l HWIO_TLMM_GPIO_INTR_CFG6_ADDR A:0x61006008
y.create.l HWIO_TLMM_GPIO_INTR_CFG7_ADDR A:0x61007008
y.create.l HWIO_TLMM_GPIO_INTR_CFG8_ADDR A:0x61008008
y.create.l HWIO_TLMM_GPIO_INTR_CFG9_ADDR A:0x61009008
y.create.l HWIO_TLMM_GPIO_INTR_STATUS0_ADDR A:0x6100000c
y.create.l HWIO_TLMM_GPIO_INTR_STATUS1_ADDR A:0x6100100c
y.create.l HWIO_TLMM_GPIO_INTR_STATUS2_ADDR A:0x6100200c
y.create.l HWIO_TLMM_GPIO_INTR_STATUS3_ADDR A:0x6100300c
y.create.l HWIO_TLMM_GPIO_INTR_STATUS4_ADDR A:0x6100400c
y.create.l HWIO_TLMM_GPIO_INTR_STATUS5_ADDR A:0x6100500c
y.create.l HWIO_TLMM_GPIO_INTR_STATUS6_ADDR A:0x6100600c
y.create.l HWIO_TLMM_GPIO_INTR_STATUS7_ADDR A:0x6100700c
y.create.l HWIO_TLMM_GPIO_INTR_STATUS8_ADDR A:0x6100800c
y.create.l HWIO_TLMM_GPIO_INTR_STATUS9_ADDR A:0x6100900c
y.create.l HWIO_TLMM_CLK_GATE_EN_ADDR A:0x61100000
y.create.l HWIO_TLMM_IE_CTRL_DISABLE_ADDR A:0x61100004
y.create.l HWIO_TLMM_MPM_WAKEUP_INT_EN_0_ADDR A:0x61100008
y.create.l HWIO_TLMM_MPM_WAKEUP_INT_EN_1_ADDR A:0x6110000c
y.create.l HWIO_TLMM_INT_JTAG_CTL_ADDR A:0x61110000
y.create.l HWIO_TLMM_ETM_MODE_ADDR A:0x61110004
y.create.l HWIO_TLMM_DBG_BUS_OUT_SEL_ADDR A:0x61110008
y.create.l HWIO_TLMM_CHIP_MODE_ADDR A:0x6111000c
y.create.l HWIO_TLMM_SPARE_ADDR A:0x6110e000
y.create.l HWIO_SPARE1_ADDR A:0x6111001c
y.create.l HWIO_SPARE2_ADDR A:0x61110020
y.create.l HWIO_TLMM_HW_REVISION_NUMBER_ADDR A:0x61110010
y.create.l HWIO_TLMM_PERIPH_CHAR_TEST_MODE_ADDR A:0x61110014
y.create.l HWIO_TLMM_EBI2_EMMC_GPIO_CFG_ADDR A:0x61111000
y.create.l HWIO_TLMM_RFFE_CTL_ADDR A:0x61108000
y.create.l HWIO_TLMM_RESOUT_HDRV_CTL_ADDR A:0x6110d000
y.create.l HWIO_TLMM_JTAG_HDRV_CTL_ADDR A:0x6110c000
y.create.l HWIO_TLMM_PMIC_HDRV_PULL_CTL_ADDR A:0x6110b000
y.create.l HWIO_TLMM_SDC1_HDRV_PULL_CTL_ADDR A:0x6110a000
y.create.l HWIO_TLMM_SLIMBUS_CTL_ADDR A:0x61109000
y.create.l HWIO_TLMM_MODE_PULL_CTL_ADDR A:0x61107000
y.create.l HWIO_RCP_SWITCH_CTL_ADDR A:0x61112000
y.create.l HWIO_TLMM_QDSD_HDRV_PULL_DEBUG_GPIO_CTL_ADDR A:0x6119c000
y.create.l HWIO_TLMM_QDSD_BOOT_CTL_ADDR A:0x6119d000
y.create.l HWIO_TLMM_QDSD_CONFIG_CTL_ADDR A:0x6119e000
y.create.l HWIO_TLMM_QDSD_STATUS_CTL_ADDR A:0x6119f000
y.create.l HWIO_TLMM_QDSD_DEBUG_HDRV_PULL_CTL_ADDR A:0x611a0000
y.create.l HWIO_TLMM_QDSD_GPIO_CTL_ADDR A:0x611a1000
y.create.l HWIO_TLMM_QDSD_INTR_ENABLE_CTL_ADDR A:0x611a2000
y.create.l HWIO_TLMM_QDSD_INTR_CLEAR_CTL_ADDR A:0x611a3000
y.create.l HWIO_TLMM_QDSD_SPARE1_CTL_ADDR A:0x611a5000
y.create.l HWIO_TLMM_QDSD_SPARE2_CTL_ADDR A:0x611a6000
y.create.l HWIO_TLMM_QDSD_HYS_CTL_ADDR A:0x611a7000
y.create.l HWIO_TLMM_QDSD_TIMEOUT_VALUE_CTL_ADDR A:0x611a4000
y.create.l HWIO_TLMM_GPIO_I2C_PAD_CTL_ADDR A:0x6110f000
y.create.l HWIO_TLMM_DIR_CONN_INTR0_CFG_SENSORS_ADDR A:0x61105000
y.create.l HWIO_TLMM_DIR_CONN_INTR1_CFG_SENSORS_ADDR A:0x61105004
y.create.l HWIO_TLMM_DIR_CONN_INTR2_CFG_SENSORS_ADDR A:0x61105008
y.create.l HWIO_TLMM_DIR_CONN_INTR3_CFG_SENSORS_ADDR A:0x6110500c
y.create.l HWIO_TLMM_DIR_CONN_INTR4_CFG_SENSORS_ADDR A:0x61105010
y.create.l HWIO_TLMM_DIR_CONN_INTR5_CFG_SENSORS_ADDR A:0x61105014
y.create.l HWIO_TLMM_DIR_CONN_INTR6_CFG_SENSORS_ADDR A:0x61105018
y.create.l HWIO_TLMM_DIR_CONN_INTR7_CFG_SENSORS_ADDR A:0x6110501c
y.create.l HWIO_TLMM_DIR_CONN_INTR8_CFG_SENSORS_ADDR A:0x61105020
y.create.l HWIO_TLMM_DIR_CONN_INTR9_CFG_SENSORS_ADDR A:0x61105024
y.create.l HWIO_TLMM_DIR_CONN_INTR0_CFG_LPA_DSP_ADDR A:0x61104000
y.create.l HWIO_TLMM_DIR_CONN_INTR1_CFG_LPA_DSP_ADDR A:0x61104004
y.create.l HWIO_TLMM_DIR_CONN_INTR2_CFG_LPA_DSP_ADDR A:0x61104008
y.create.l HWIO_TLMM_DIR_CONN_INTR3_CFG_LPA_DSP_ADDR A:0x6110400c
y.create.l HWIO_TLMM_DIR_CONN_INTR4_CFG_LPA_DSP_ADDR A:0x61104010
y.create.l HWIO_TLMM_DIR_CONN_INTR5_CFG_LPA_DSP_ADDR A:0x61104014
y.create.l HWIO_TLMM_DIR_CONN_INTR0_CFG_RPM_ADDR A:0x61103000
y.create.l HWIO_TLMM_DIR_CONN_INTR0_CFG_APSS_ADDR A:0x61102000
y.create.l HWIO_TLMM_DIR_CONN_INTR1_CFG_APSS_ADDR A:0x61102004
y.create.l HWIO_TLMM_DIR_CONN_INTR2_CFG_APSS_ADDR A:0x61102008
y.create.l HWIO_TLMM_DIR_CONN_INTR3_CFG_APSS_ADDR A:0x6110200c
y.create.l HWIO_TLMM_DIR_CONN_INTR4_CFG_APSS_ADDR A:0x61102010
y.create.l HWIO_TLMM_DIR_CONN_INTR5_CFG_APSS_ADDR A:0x61102014
y.create.l HWIO_TLMM_DIR_CONN_INTR6_CFG_APSS_ADDR A:0x61102018
y.create.l HWIO_TLMM_DIR_CONN_INTR7_CFG_APSS_ADDR A:0x6110201c
y.create.l HWIO_TLMM_DIR_CONN_INTR0_CFG_MSS_ADDR A:0x61101000
y.create.l HWIO_TLMM_DIR_CONN_INTR1_CFG_MSS_ADDR A:0x61101004
y.create.l HWIO_TLMM_GPIO_OUT_0_ADDR A:0x61200000
y.create.l HWIO_TLMM_GPIO_OUT_1_ADDR A:0x61200004
y.create.l HWIO_TLMM_GPIO_OUT_2_ADDR A:0x61200008
y.create.l HWIO_TLMM_GPIO_OUT_3_ADDR A:0x6120000c
y.create.l HWIO_TLMM_GPIO_OUT_CLR_0_ADDR A:0x61200020
y.create.l HWIO_TLMM_GPIO_OUT_CLR_1_ADDR A:0x61200024
y.create.l HWIO_TLMM_GPIO_OUT_CLR_2_ADDR A:0x61200028
y.create.l HWIO_TLMM_GPIO_OUT_CLR_3_ADDR A:0x6120002c
y.create.l HWIO_TLMM_GPIO_OUT_SET_0_ADDR A:0x61200040
y.create.l HWIO_TLMM_GPIO_OUT_SET_1_ADDR A:0x61200044
y.create.l HWIO_TLMM_GPIO_OUT_SET_2_ADDR A:0x61200048
y.create.l HWIO_TLMM_GPIO_OUT_SET_3_ADDR A:0x6120004c
y.create.l HWIO_TLMM_GPIO_IN_0_ADDR A:0x61200060
y.create.l HWIO_TLMM_GPIO_IN_1_ADDR A:0x61200064
y.create.l HWIO_TLMM_GPIO_IN_2_ADDR A:0x61200068
y.create.l HWIO_TLMM_GPIO_IN_3_ADDR A:0x6120006c
y.create.l HWIO_TLMM_GPIO_OE_0_ADDR A:0x61200080
y.create.l HWIO_TLMM_GPIO_OE_1_ADDR A:0x61200084
y.create.l HWIO_TLMM_GPIO_OE_2_ADDR A:0x61200088
y.create.l HWIO_TLMM_GPIO_OE_3_ADDR A:0x6120008c
y.create.l HWIO_TLMM_GPIO_OE_CLR_0_ADDR A:0x612000a0
y.create.l HWIO_TLMM_GPIO_OE_CLR_1_ADDR A:0x612000a4
y.create.l HWIO_TLMM_GPIO_OE_CLR_2_ADDR A:0x612000a8
y.create.l HWIO_TLMM_GPIO_OE_CLR_3_ADDR A:0x612000ac
y.create.l HWIO_TLMM_GPIO_OE_SET_0_ADDR A:0x612000c0
y.create.l HWIO_TLMM_GPIO_OE_SET_1_ADDR A:0x612000c4
y.create.l HWIO_TLMM_GPIO_OE_SET_2_ADDR A:0x612000c8
y.create.l HWIO_TLMM_GPIO_OE_SET_3_ADDR A:0x612000cc
y.create.l HWIO_ULTAUDIO_HW_VERSION_ADDR A:0x67700000
y.create.l HWIO_ULTAUDIO_TCSR_DEBUG_CTL_ADDR A:0x67700004
y.create.l HWIO_LPASS_CSR_GP_CTL_ADDR A:0x67700100
y.create.l HWIO_LPASS_CSR_MEMTYPE_CTL_ADDR A:0x67700104
y.create.l HWIO_LPASS_CSR_DEBUG_BUS_ADDR A:0x67700114
y.create.l HWIO_LPASS_AHBI_CFG_ADDR A:0x67700124
y.create.l HWIO_LPASS_AHBI_LOCK_CTL_ADDR A:0x67700128
y.create.l HWIO_LPASS_AHBI_CFG_EXT_ADDR A:0x6770012c
y.create.l HWIO_LPASS_AHBX_CFG_ADDR A:0x67700140
y.create.l HWIO_LPASS_AHBX_LOCK_CTL_ADDR A:0x67700144
y.create.l HWIO_LPASS_AHBIX_STATUS_ADDR A:0x67700150
y.create.l HWIO_LPASS_AHBIX_ACK_ADDR A:0x67700154
y.create.l HWIO_LPASS_AHBIX_EN_ADDR A:0x67700158
y.create.l HWIO_LPASS_AUDIO_CORE_LPM_CGCR_ADDR A:0x6770015c
y.create.l HWIO_LPASS_AUDIO_CORE_AUDSYNC_CGCR_ADDR A:0x67700160
y.create.l HWIO_LPASS_AUDIO_CORE_AVSYNC_CGCR_ADDR A:0x67700164
y.create.l HWIO_LPASS_AUDIO_CORE_AHB2AHB_CODEC_CGCR_ADDR A:0x6770016c
y.create.l HWIO_LPASS_AUDIO_CORE_LPAIF_CTL_CGCR_ADDR A:0x67700170
y.create.l HWIO_LPASS_AUDIO_CORE_VFR_CGCR_ADDR A:0x67700174
y.create.l HWIO_LPASS_AUDIO_CORE_AHB2AHB_PCNOC_SLV_CGCR_ADDR A:0x67700178
y.create.l HWIO_LPASS_AUDIO_CORE_AHB2AHB_PCNOC_MST_CGCR_ADDR A:0x6770017c
y.create.l HWIO_LPASS_AUDIO_CORE_AVTIMER_XO_FM_CGCR_ADDR A:0x67700180
y.create.l HWIO_LPASS_AUDIO_CORE_AVTIMER_XO_BT_CGCR_ADDR A:0x67700184
y.create.l HWIO_LPASS_AUDIO_CORE_SLIMBUS_SLV_CGCR_ADDR A:0x67700188
y.create.l HWIO_LPASS_AUDIO_CORE_SLIMBUS_MST_CGCR_ADDR A:0x6770018c
y.create.l HWIO_LPASS_LPASS_CSR_ADDR_VALID_STATUS_ADDR A:0x67700190
y.create.l HWIO_LPASS_LPASS_CSR_ADDR_VALID_ACK_ADDR A:0x67700194
y.create.l HWIO_LPASS_LPASS_CSR_ADDR_VALID_EN_ADDR A:0x67700198
y.create.l HWIO_LPASS_LPM_CTL_ADDR A:0x6770019c
y.create.l HWIO_LPASS_LPAIF_CTL_ADDR A:0x677001b0
y.create.l HWIO_LPASS_STM_MUXSEL_0_ADDR A:0x677001b4
y.create.l HWIO_LPASS_STM_MUXSEL_1_ADDR A:0x677001b8
y.create.l HWIO_LPASS_STM_MUXSEL_2_ADDR A:0x677001bc
y.create.l HWIO_LPASS_STM_MUXSEL_3_ADDR A:0x677001c0
y.create.l HWIO_LPASS_STM_MUXSEL_4_ADDR A:0x677001c4
y.create.l HWIO_LPASS_STM_MUXSEL_5_ADDR A:0x677001c8
y.create.l HWIO_LPASS_STM_MUXSEL_6_ADDR A:0x677001cc
y.create.l HWIO_LPASS_STM_MUXSEL_7_ADDR A:0x677001d0
y.create.l HWIO_LPASS_STM_MUXSEL_8_ADDR A:0x677001d4
y.create.l HWIO_LPASS_STM_MUXSEL_9_ADDR A:0x677001d8
y.create.l HWIO_LPASS_VFR_IRQ_MUX_CTL_ADDR A:0x67701000
y.create.l HWIO_LPASS_VFR_STC_MSB_ADDR A:0x67701004
y.create.l HWIO_LPASS_VFR_STC_LSB_ADDR A:0x67701008
y.create.l HWIO_LPASS_VFR_IRQ_MUX_CTL_1_ADDR A:0x67701010
y.create.l HWIO_LPASS_VFR_STC_MSB_1_ADDR A:0x67701014
y.create.l HWIO_LPASS_VFR_STC_LSB_1_ADDR A:0x67701018
y.create.l HWIO_LPASS_GP_IRQ_TS_MUX_CTL_0_ADDR A:0x67701020
y.create.l HWIO_LPASS_GP_IRQ_STC_MSB_0_ADDR A:0x67701024
y.create.l HWIO_LPASS_GP_IRQ_STC_LSB_0_ADDR A:0x67701028
y.create.l HWIO_LPASS_GP_IRQ_TS_MUX_CTL_1_ADDR A:0x67701030
y.create.l HWIO_LPASS_GP_IRQ_STC_MSB_1_ADDR A:0x67701034
y.create.l HWIO_LPASS_GP_IRQ_STC_LSB_1_ADDR A:0x67701038
y.create.l HWIO_LPASS_LPAIF_VFR_IRQ_CTL_ADDR A:0x67701040
y.create.l HWIO_LPASS_WCN_VFR_IRQ_CTL_ADDR A:0x67701044
y.create.l HWIO_LPASS_AVT_VFR_IRQ_CTL_ADDR A:0x67701048
y.create.l HWIO_LPASS_SLIMBUS_VFR_IRQ_CTL_ADDR A:0x6770104c
y.create.l HWIO_LPASS_CSR_GP_IO_MUX_MIC_CTL_ADDR A:0x67702000
y.create.l HWIO_LPASS_CSR_GP_IO_MUX_SPKR_CTL_ADDR A:0x67702004
y.create.l HWIO_LPASS_CSR_GP_LPAIF_PRI_PCM_PRI_MODE_MUXSEL_ADDR A:0x67702008
y.create.l HWIO_LPASS_CSR_GP_LPAIF_SEC_PCM_SEC_MODE_MUXSEL_ADDR A:0x6770200c
y.create.l HWIO_LPASS_CSR_GP_LPAIF_TER_PCM_PRI_MODE_MUXSEL_ADDR A:0x67702010
y.create.l HWIO_LPASS_AHBI_ABT_HW_VERSION_ADDR A:0x67705000
y.create.l HWIO_LPASS_AHBI_ABT_INST_ID_ADDR A:0x67705004
y.create.l HWIO_LPASS_AHBI_ABT_NUM_SLAVES_ADDR A:0x67705008
y.create.l HWIO_LPASS_AHBI_ABT_TIMER_LOADVAL_ADDR A:0x6770500c
y.create.l HWIO_LPASS_AHBI_ABT_TIMER_MODE_ADDR A:0x67705010
y.create.l HWIO_LPASS_AHBI_ABT_INTR_STATUS_ADDR A:0x67705014
y.create.l HWIO_LPASS_AHBI_ABT_INTR_CLEAR_ADDR A:0x67705018
y.create.l HWIO_LPASS_AHBI_ABT_INTR_ENABLE_ADDR A:0x6770501c
y.create.l HWIO_LPASS_AHBI_ABT_SYND_VALID_ADDR A:0x67705020
y.create.l HWIO_LPASS_AHBI_ABT_SYND_CLEAR_ADDR A:0x67705024
y.create.l HWIO_LPASS_AHBI_ABT_SYND_ID_ADDR A:0x67705028
y.create.l HWIO_LPASS_AHBI_ABT_SYND_ADDR0_ADDR A:0x6770502c
y.create.l HWIO_LPASS_AHBI_ABT_SYND_ADDR1_ADDR A:0x67705030
y.create.l HWIO_LPASS_AHBI_ABT_SYND_HREADY_ADDR A:0x67705034
y.create.l HWIO_LPASS_AVTIMER_HW_VERSION_ADDR A:0x67706000
y.create.l HWIO_LPASS_AVTIMER_CTL_ADDR A:0x67706004
y.create.l HWIO_LPASS_AVTIMER_RESMOD_ADDR A:0x67706008
y.create.l HWIO_LPASS_AVTIMER_TIMER_LSB_ADDR A:0x6770600c
y.create.l HWIO_LPASS_AVTIMER_TIMER_MSB_ADDR A:0x67706010
y.create.l HWIO_LPASS_AVTIMER_INT0_LSB_ADDR A:0x67706014
y.create.l HWIO_LPASS_AVTIMER_INT0_MSB_ADDR A:0x67706018
y.create.l HWIO_LPASS_AVTIMER_INT1_LSB_ADDR A:0x6770601c
y.create.l HWIO_LPASS_AVTIMER_INT1_MSB_ADDR A:0x67706020
y.create.l HWIO_LPASS_AVTIMER_TIMEOUT_VAL_ADDR A:0x67706024
y.create.l HWIO_LPASS_AVTIMER_L0_VAL_NEXT_ADDR A:0x67706028
y.create.l HWIO_LPASS_AVTIMER_M0_VAL_NEXT_ADDR A:0x6770602c
y.create.l HWIO_LPASS_AVTIMER_N0_VAL_NEXT_ADDR A:0x67706030
y.create.l HWIO_LPASS_AVTIMER_L0_VAL_CURR_ADDR A:0x67706034
y.create.l HWIO_LPASS_AVTIMER_M0_VAL_CURR_ADDR A:0x67706038
y.create.l HWIO_LPASS_AVTIMER_N0_VAL_CURR_ADDR A:0x6770603c
y.create.l HWIO_LPASS_AVTIMER_MODE_CTL_ADDR A:0x67706040
y.create.l HWIO_LPASS_AVTIMER_LMN_DWT_ADDR A:0x67706044
y.create.l HWIO_LPASS_AVTIMER_LTIME_LSB_ADDR A:0x67706048
y.create.l HWIO_LPASS_AVTIMER_LTIME_MSB_ADDR A:0x6770604c
y.create.l HWIO_LPASS_AVTIMER_EXT_STC_LSB_ADDR A:0x67706050
y.create.l HWIO_LPASS_AVTIMER_EXT_STC_MSB_ADDR A:0x67706054
y.create.l HWIO_LPASS_AVTIMER_RTIME_LSB_ADDR A:0x67706058
y.create.l HWIO_LPASS_AVTIMER_RTIME_MSB_ADDR A:0x6770605c
y.create.l HWIO_LPASS_AVTIMER_RTIME_CTL_ADDR A:0x67706060
y.create.l HWIO_LPASS_AVTIMER_TIME_CTL_ADDR A:0x67706064
y.create.l HWIO_LPASS_AVTIMER_TIMER_LOAD_LSB_NEXT_ADDR A:0x67706068
y.create.l HWIO_LPASS_AVTIMER_TIMER_LOAD_MSB_NEXT_ADDR A:0x6770606c
y.create.l HWIO_LPASS_AVTIMER_TIMER_LOAD_LSB_CURR_ADDR A:0x67706070
y.create.l HWIO_LPASS_AVTIMER_TIMER_LOAD_MSB_CURR_ADDR A:0x67706074
y.create.l HWIO_LPASS_AVTIMER_TIMER_LOAD_DWT_ADDR A:0x67706078
y.create.l HWIO_LPASS_AVTIMER_INT1_ST_ADDR A:0x6770607c
y.create.l HWIO_LPASS_AVTIMER_INT0_ST_ADDR A:0x67706080
y.create.l HWIO_LPASS_AVTIMER_INT1_CTL_ADDR A:0x67706084
y.create.l HWIO_LPASS_AVTIMER_INT0_CTL_ADDR A:0x67706088
y.create.l HWIO_LPASS_AVTIMER_INT_ON_ADDR A:0x6770608c
y.create.l HWIO_LPASS_AVTIMER_TICK_DIV_ADDR A:0x67706090
y.create.l HWIO_LPASS_LPAIF_VERSION_ADDR A:0x67708000
y.create.l HWIO_LPASS_LPAIF_HW_CONFIG_ADDR A:0x67708004
y.create.l HWIO_LPASS_LPAIF_HW_CONFIG2_ADDR A:0x67708008
y.create.l HWIO_LPASS_LPAIF_DMIC_CTL_ADDR A:0x67708080
y.create.l HWIO_LPASS_LPAIF_DMIC_VOL_CTL0_ADDR A:0x67708084
y.create.l HWIO_LPASS_LPAIF_DMIC_VOL_CTL1_ADDR A:0x67708088
y.create.l HWIO_LPASS_LPAIF_WRDMA_LPBK_MIX_ADDR A:0x67708100
y.create.l HWIO_LPASS_LPAIF_MIXER_CTL_ADDR A:0x67708180
y.create.l HWIO_LPASS_LPAIF_EXT_VFR_ADDR A:0x67708200
y.create.l HWIO_LPASS_LPAIF_DEBUG_CTL_ADDR A:0x67708280
y.create.l HWIO_LPASS_LPAIF_PRI_RATE_DET_CONFIG_ADDR A:0x67708300
y.create.l HWIO_LPASS_LPAIF_PRI_RATE_DET_TARGET1_CONFIG_ADDR A:0x67708304
y.create.l HWIO_LPASS_LPAIF_PRI_RATE_DET_TARGET2_CONFIG_ADDR A:0x67708308
y.create.l HWIO_LPASS_LPAIF_PRI_RATE_BIN_ADDR A:0x6770830c
y.create.l HWIO_LPASS_LPAIF_PRI_STC_DIFF_ADDR A:0x67708310
y.create.l HWIO_LPASS_LPAIF_SEC_RATE_DET_CONFIG_ADDR A:0x67708380
y.create.l HWIO_LPASS_LPAIF_SEC_RATE_DET_TARGET1_CONFIG_ADDR A:0x67708384
y.create.l HWIO_LPASS_LPAIF_SEC_RATE_DET_TARGET2_CONFIG_ADDR A:0x67708388
y.create.l HWIO_LPASS_LPAIF_SEC_RATE_BIN_ADDR A:0x6770838c
y.create.l HWIO_LPASS_LPAIF_SEC_STC_DIFF_ADDR A:0x67708390
y.create.l HWIO_LPASS_LPAIF_SPARE_ADDR A:0x67708400
y.create.l HWIO_LPASS_LPAIF_I2S_CTL0_ADDR A:0x67709000
y.create.l HWIO_LPASS_LPAIF_I2S_CTL1_ADDR A:0x6770a000
y.create.l HWIO_LPASS_LPAIF_PCM_CTL0_ADDR A:0x67709040
y.create.l HWIO_LPASS_LPAIF_PCM_CTL1_ADDR A:0x6770a040
y.create.l HWIO_LPASS_LPAIF_PCM_SLOT_CTL0_ADDR A:0x67709044
y.create.l HWIO_LPASS_LPAIF_PCM_SLOT_CTL1_ADDR A:0x6770a044
y.create.l HWIO_LPASS_LPAIF_PCM_SLOT_CTL2_0_ADDR A:0x67709048
y.create.l HWIO_LPASS_LPAIF_PCM_SLOT_CTL2_1_ADDR A:0x6770a048
y.create.l HWIO_LPASS_LPAIF_PCM_SLOT_CTL3_0_ADDR A:0x6770904c
y.create.l HWIO_LPASS_LPAIF_PCM_SLOT_CTL3_1_ADDR A:0x6770a04c
y.create.l HWIO_LPASS_LPAIF_PCM_TDM_CTL_0_ADDR A:0x67709050
y.create.l HWIO_LPASS_LPAIF_PCM_TDM_CTL_1_ADDR A:0x6770a050
y.create.l HWIO_LPASS_LPAIF_PCM_TDM_SAMPLE_WIDTH_0_ADDR A:0x67709054
y.create.l HWIO_LPASS_LPAIF_PCM_TDM_SAMPLE_WIDTH_1_ADDR A:0x6770a054
y.create.l HWIO_LPASS_LPAIF_IRQ_EN0_ADDR A:0x6770e000
y.create.l HWIO_LPASS_LPAIF_IRQ_EN1_ADDR A:0x6770f000
y.create.l HWIO_LPASS_LPAIF_IRQ_EN2_ADDR A:0x67710000
y.create.l HWIO_LPASS_LPAIF_IRQ_STAT0_ADDR A:0x6770e004
y.create.l HWIO_LPASS_LPAIF_IRQ_STAT1_ADDR A:0x6770f004
y.create.l HWIO_LPASS_LPAIF_IRQ_STAT2_ADDR A:0x67710004
y.create.l HWIO_LPASS_LPAIF_IRQ_RAW_STAT0_ADDR A:0x6770e008
y.create.l HWIO_LPASS_LPAIF_IRQ_RAW_STAT1_ADDR A:0x6770f008
y.create.l HWIO_LPASS_LPAIF_IRQ_RAW_STAT2_ADDR A:0x67710008
y.create.l HWIO_LPASS_LPAIF_IRQ_CLEAR0_ADDR A:0x6770e00c
y.create.l HWIO_LPASS_LPAIF_IRQ_CLEAR1_ADDR A:0x6770f00c
y.create.l HWIO_LPASS_LPAIF_IRQ_CLEAR2_ADDR A:0x6771000c
y.create.l HWIO_LPASS_LPAIF_IRQ_FORCE0_ADDR A:0x6770e010
y.create.l HWIO_LPASS_LPAIF_IRQ_FORCE1_ADDR A:0x6770f010
y.create.l HWIO_LPASS_LPAIF_IRQ_FORCE2_ADDR A:0x67710010
y.create.l HWIO_LPASS_LPAIF_RDDMA_CTL0_ADDR A:0x67710400
y.create.l HWIO_LPASS_LPAIF_RDDMA_CTL1_ADDR A:0x67711400
y.create.l HWIO_LPASS_LPAIF_RDDMA_BASE0_ADDR A:0x67710404
y.create.l HWIO_LPASS_LPAIF_RDDMA_BASE1_ADDR A:0x67711404
y.create.l HWIO_LPASS_LPAIF_RDDMA_BUFF_LEN0_ADDR A:0x67710408
y.create.l HWIO_LPASS_LPAIF_RDDMA_BUFF_LEN1_ADDR A:0x67711408
y.create.l HWIO_LPASS_LPAIF_RDDMA_CURR_ADDR0_ADDR A:0x6771040c
y.create.l HWIO_LPASS_LPAIF_RDDMA_CURR_ADDR1_ADDR A:0x6771140c
y.create.l HWIO_LPASS_LPAIF_RDDMA_PER_LEN0_ADDR A:0x67710410
y.create.l HWIO_LPASS_LPAIF_RDDMA_PER_LEN1_ADDR A:0x67711410
y.create.l HWIO_LPASS_LPAIF_RDDMA_PER_CNT0_ADDR A:0x67710414
y.create.l HWIO_LPASS_LPAIF_RDDMA_PER_CNT1_ADDR A:0x67711414
y.create.l HWIO_LPASS_LPAIF_RDDMA_FRM0_ADDR A:0x67710418
y.create.l HWIO_LPASS_LPAIF_RDDMA_FRM1_ADDR A:0x67711418
y.create.l HWIO_LPASS_LPAIF_RDDMA_FRMCLR0_ADDR A:0x6771041c
y.create.l HWIO_LPASS_LPAIF_RDDMA_FRMCLR1_ADDR A:0x6771141c
y.create.l HWIO_LPASS_LPAIF_RDDMA_SET_BUFF_CNT0_ADDR A:0x67710420
y.create.l HWIO_LPASS_LPAIF_RDDMA_SET_BUFF_CNT1_ADDR A:0x67711420
y.create.l HWIO_LPASS_LPAIF_RDDMA_SET_PER_CNT0_ADDR A:0x67710424
y.create.l HWIO_LPASS_LPAIF_RDDMA_SET_PER_CNT1_ADDR A:0x67711424
y.create.l HWIO_LPASS_LPAIF_RDDMA_STC_LSB0_ADDR A:0x67710428
y.create.l HWIO_LPASS_LPAIF_RDDMA_STC_LSB1_ADDR A:0x67711428
y.create.l HWIO_LPASS_LPAIF_RDDMA_STC_MSB0_ADDR A:0x6771042c
y.create.l HWIO_LPASS_LPAIF_RDDMA_STC_MSB1_ADDR A:0x6771142c
y.create.l HWIO_LPASS_LPAIF_RDDMA_PER0_ADDR A:0x67710430
y.create.l HWIO_LPASS_LPAIF_RDDMA_PER1_ADDR A:0x67711430
y.create.l HWIO_LPASS_LPAIF_RDDMA_PERCLR0_ADDR A:0x67710434
y.create.l HWIO_LPASS_LPAIF_RDDMA_PERCLR1_ADDR A:0x67711434
y.create.l HWIO_LPASS_LPAIF_RDDMA_BASE_EXT0_ADDR A:0x67710438
y.create.l HWIO_LPASS_LPAIF_RDDMA_BASE_EXT1_ADDR A:0x67711438
y.create.l HWIO_LPASS_LPAIF_RDDMA_CURR_ADDR_EXT0_ADDR A:0x6771043c
y.create.l HWIO_LPASS_LPAIF_RDDMA_CURR_ADDR_EXT1_ADDR A:0x6771143c
y.create.l HWIO_LPASS_LPAIF_WRDMA_CTL0_ADDR A:0x67713000
y.create.l HWIO_LPASS_LPAIF_WRDMA_CTL1_ADDR A:0x67714000
y.create.l HWIO_LPASS_LPAIF_WRDMA_BASE0_ADDR A:0x67713004
y.create.l HWIO_LPASS_LPAIF_WRDMA_BASE1_ADDR A:0x67714004
y.create.l HWIO_LPASS_LPAIF_WRDMA_BUFF_LEN0_ADDR A:0x67713008
y.create.l HWIO_LPASS_LPAIF_WRDMA_BUFF_LEN1_ADDR A:0x67714008
y.create.l HWIO_LPASS_LPAIF_WRDMA_CURR_ADDR0_ADDR A:0x6771300c
y.create.l HWIO_LPASS_LPAIF_WRDMA_CURR_ADDR1_ADDR A:0x6771400c
y.create.l HWIO_LPASS_LPAIF_WRDMA_PER_LEN0_ADDR A:0x67713010
y.create.l HWIO_LPASS_LPAIF_WRDMA_PER_LEN1_ADDR A:0x67714010
y.create.l HWIO_LPASS_LPAIF_WRDMA_PER_CNT0_ADDR A:0x67713014
y.create.l HWIO_LPASS_LPAIF_WRDMA_PER_CNT1_ADDR A:0x67714014
y.create.l HWIO_LPASS_LPAIF_WRDMA_FRM0_ADDR A:0x67713018
y.create.l HWIO_LPASS_LPAIF_WRDMA_FRM1_ADDR A:0x67714018
y.create.l HWIO_LPASS_LPAIF_WRDMA_FRMCLR0_ADDR A:0x6771301c
y.create.l HWIO_LPASS_LPAIF_WRDMA_FRMCLR1_ADDR A:0x6771401c
y.create.l HWIO_LPASS_LPAIF_WRDMA_SET_BUFF_CNT0_ADDR A:0x67713020
y.create.l HWIO_LPASS_LPAIF_WRDMA_SET_BUFF_CNT1_ADDR A:0x67714020
y.create.l HWIO_LPASS_LPAIF_WRDMA_SET_PER_CNT0_ADDR A:0x67713024
y.create.l HWIO_LPASS_LPAIF_WRDMA_SET_PER_CNT1_ADDR A:0x67714024
y.create.l HWIO_LPASS_LPAIF_WRDMA_STC_LSB0_ADDR A:0x67713028
y.create.l HWIO_LPASS_LPAIF_WRDMA_STC_LSB1_ADDR A:0x67714028
y.create.l HWIO_LPASS_LPAIF_WRDMA_STC_MSB0_ADDR A:0x6771302c
y.create.l HWIO_LPASS_LPAIF_WRDMA_STC_MSB1_ADDR A:0x6771402c
y.create.l HWIO_LPASS_LPAIF_WRDMA_PER0_ADDR A:0x67713030
y.create.l HWIO_LPASS_LPAIF_WRDMA_PER1_ADDR A:0x67714030
y.create.l HWIO_LPASS_LPAIF_WRDMA_PERCLR0_ADDR A:0x67713034
y.create.l HWIO_LPASS_LPAIF_WRDMA_PERCLR1_ADDR A:0x67714034
y.create.l HWIO_LPASS_LPAIF_WRDMA_BASE_EXT0_ADDR A:0x67713038
y.create.l HWIO_LPASS_LPAIF_WRDMA_BASE_EXT1_ADDR A:0x67714038
y.create.l HWIO_LPASS_LPAIF_WRDMA_CURR_ADDR_EXT0_ADDR A:0x6771303c
y.create.l HWIO_LPASS_LPAIF_WRDMA_CURR_ADDR_EXT1_ADDR A:0x6771403c
y.create.l HWIO_LPASS_SB_BAM_CTRL_ADDR A:0x67784000
y.create.l HWIO_LPASS_SB_BAM_TIMER_ADDR A:0x67784040
y.create.l HWIO_LPASS_SB_BAM_TIMER_CTRL_ADDR A:0x67784044
y.create.l HWIO_LPASS_SB_BAM_DESC_CNT_TRSHLD_ADDR A:0x67784008
y.create.l HWIO_LPASS_SB_BAM_IRQ_STTS_ADDR A:0x67784014
y.create.l HWIO_LPASS_SB_BAM_IRQ_CLR_ADDR A:0x67784018
y.create.l HWIO_LPASS_SB_BAM_IRQ_EN_ADDR A:0x6778401c
y.create.l HWIO_LPASS_SB_BAM_CNFG_BITS_ADDR A:0x6778407c
y.create.l HWIO_LPASS_SB_BAM_CNFG_BITS_2_ADDR A:0x67784084
y.create.l HWIO_LPASS_SB_BAM_REVISION_ADDR A:0x67785000
y.create.l HWIO_LPASS_SB_BAM_SW_VERSION_ADDR A:0x67785004
y.create.l HWIO_LPASS_SB_BAM_NUM_PIPES_ADDR A:0x67785008
y.create.l HWIO_LPASS_SB_BAM_TEST_BUS_SEL_ADDR A:0x67785010
y.create.l HWIO_LPASS_SB_BAM_TEST_BUS_REG_ADDR A:0x67785014
y.create.l HWIO_LPASS_SB_BAM_AHB_MASTER_ERR_CTRLS_ADDR A:0x67785024
y.create.l HWIO_LPASS_SB_BAM_AHB_MASTER_ERR_ADDR_ADDR A:0x67785028
y.create.l HWIO_LPASS_SB_BAM_AHB_MASTER_ERR_DATA_ADDR A:0x6778502c
y.create.l HWIO_LPASS_SB_BAM_AHB_MASTER_ERR_ADDR_LSB_ADDR A:0x67785100
y.create.l HWIO_LPASS_SB_BAM_AHB_MASTER_ERR_ADDR_MSB_ADDR A:0x67785104
y.create.l HWIO_LPASS_SB_BAM_TRUST_REG_ADDR A:0x67786000
y.create.l HWIO_LPASS_SB_BAM_P_TRUST_REG0_ADDR A:0x67786020
y.create.l HWIO_LPASS_SB_BAM_P_TRUST_REG1_ADDR A:0x67786024
y.create.l HWIO_LPASS_SB_BAM_P_TRUST_REG2_ADDR A:0x67786028
y.create.l HWIO_LPASS_SB_BAM_P_TRUST_REG3_ADDR A:0x6778602c
y.create.l HWIO_LPASS_SB_BAM_P_TRUST_REG4_ADDR A:0x67786030
y.create.l HWIO_LPASS_SB_BAM_P_TRUST_REG5_ADDR A:0x67786034
y.create.l HWIO_LPASS_SB_BAM_P_TRUST_REG6_ADDR A:0x67786038
y.create.l HWIO_LPASS_SB_BAM_P_TRUST_REG7_ADDR A:0x6778603c
y.create.l HWIO_LPASS_SB_BAM_P_TRUST_REG8_ADDR A:0x67786040
y.create.l HWIO_LPASS_SB_BAM_P_TRUST_REG9_ADDR A:0x67786044
y.create.l HWIO_LPASS_SB_BAM_IRQ_SRCS_EE0_ADDR A:0x67787000
y.create.l HWIO_LPASS_SB_BAM_IRQ_SRCS_EE1_ADDR A:0x67788000
y.create.l HWIO_LPASS_SB_BAM_IRQ_SRCS_EE2_ADDR A:0x67789000
y.create.l HWIO_LPASS_SB_BAM_IRQ_SRCS_EE3_ADDR A:0x6778a000
y.create.l HWIO_LPASS_SB_BAM_IRQ_SRCS_EE4_ADDR A:0x6778b000
y.create.l HWIO_LPASS_SB_BAM_IRQ_SRCS_EE5_ADDR A:0x6778c000
y.create.l HWIO_LPASS_SB_BAM_IRQ_SRCS_EE6_ADDR A:0x6778d000
y.create.l HWIO_LPASS_SB_BAM_IRQ_SRCS_EE7_ADDR A:0x6778e000
y.create.l HWIO_LPASS_SB_BAM_IRQ_SRCS_MSK_EE0_ADDR A:0x67787004
y.create.l HWIO_LPASS_SB_BAM_IRQ_SRCS_MSK_EE1_ADDR A:0x67788004
y.create.l HWIO_LPASS_SB_BAM_IRQ_SRCS_MSK_EE2_ADDR A:0x67789004
y.create.l HWIO_LPASS_SB_BAM_IRQ_SRCS_MSK_EE3_ADDR A:0x6778a004
y.create.l HWIO_LPASS_SB_BAM_IRQ_SRCS_MSK_EE4_ADDR A:0x6778b004
y.create.l HWIO_LPASS_SB_BAM_IRQ_SRCS_MSK_EE5_ADDR A:0x6778c004
y.create.l HWIO_LPASS_SB_BAM_IRQ_SRCS_MSK_EE6_ADDR A:0x6778d004
y.create.l HWIO_LPASS_SB_BAM_IRQ_SRCS_MSK_EE7_ADDR A:0x6778e004
y.create.l HWIO_LPASS_SB_BAM_IRQ_SRCS_UNMASKED_EE0_ADDR A:0x67787008
y.create.l HWIO_LPASS_SB_BAM_IRQ_SRCS_UNMASKED_EE1_ADDR A:0x67788008
y.create.l HWIO_LPASS_SB_BAM_IRQ_SRCS_UNMASKED_EE2_ADDR A:0x67789008
y.create.l HWIO_LPASS_SB_BAM_IRQ_SRCS_UNMASKED_EE3_ADDR A:0x6778a008
y.create.l HWIO_LPASS_SB_BAM_IRQ_SRCS_UNMASKED_EE4_ADDR A:0x6778b008
y.create.l HWIO_LPASS_SB_BAM_IRQ_SRCS_UNMASKED_EE5_ADDR A:0x6778c008
y.create.l HWIO_LPASS_SB_BAM_IRQ_SRCS_UNMASKED_EE6_ADDR A:0x6778d008
y.create.l HWIO_LPASS_SB_BAM_IRQ_SRCS_UNMASKED_EE7_ADDR A:0x6778e008
y.create.l HWIO_LPASS_SB_BAM_PIPE_ATTR_EE0_ADDR A:0x6778700c
y.create.l HWIO_LPASS_SB_BAM_PIPE_ATTR_EE1_ADDR A:0x6778800c
y.create.l HWIO_LPASS_SB_BAM_PIPE_ATTR_EE2_ADDR A:0x6778900c
y.create.l HWIO_LPASS_SB_BAM_PIPE_ATTR_EE3_ADDR A:0x6778a00c
y.create.l HWIO_LPASS_SB_BAM_PIPE_ATTR_EE4_ADDR A:0x6778b00c
y.create.l HWIO_LPASS_SB_BAM_PIPE_ATTR_EE5_ADDR A:0x6778c00c
y.create.l HWIO_LPASS_SB_BAM_PIPE_ATTR_EE6_ADDR A:0x6778d00c
y.create.l HWIO_LPASS_SB_BAM_PIPE_ATTR_EE7_ADDR A:0x6778e00c
y.create.l HWIO_LPASS_SB_BAM_IRQ_SRCS_ADDR A:0x67787010
y.create.l HWIO_LPASS_SB_BAM_IRQ_SRCS_MSK_ADDR A:0x67787014
y.create.l HWIO_LPASS_SB_BAM_IRQ_SRCS_UNMASKED_ADDR A:0x67787018
y.create.l HWIO_LPASS_SB_BAM_P_CTRL0_ADDR A:0x67797000
y.create.l HWIO_LPASS_SB_BAM_P_CTRL1_ADDR A:0x67798000
y.create.l HWIO_LPASS_SB_BAM_P_CTRL2_ADDR A:0x67799000
y.create.l HWIO_LPASS_SB_BAM_P_CTRL3_ADDR A:0x6779a000
y.create.l HWIO_LPASS_SB_BAM_P_CTRL4_ADDR A:0x6779b000
y.create.l HWIO_LPASS_SB_BAM_P_CTRL5_ADDR A:0x6779c000
y.create.l HWIO_LPASS_SB_BAM_P_CTRL6_ADDR A:0x6779d000
y.create.l HWIO_LPASS_SB_BAM_P_CTRL7_ADDR A:0x6779e000
y.create.l HWIO_LPASS_SB_BAM_P_CTRL8_ADDR A:0x6779f000
y.create.l HWIO_LPASS_SB_BAM_P_CTRL9_ADDR A:0x677a0000
y.create.l HWIO_LPASS_SB_BAM_P_RST0_ADDR A:0x67797004
y.create.l HWIO_LPASS_SB_BAM_P_RST1_ADDR A:0x67798004
y.create.l HWIO_LPASS_SB_BAM_P_RST2_ADDR A:0x67799004
y.create.l HWIO_LPASS_SB_BAM_P_RST3_ADDR A:0x6779a004
y.create.l HWIO_LPASS_SB_BAM_P_RST4_ADDR A:0x6779b004
y.create.l HWIO_LPASS_SB_BAM_P_RST5_ADDR A:0x6779c004
y.create.l HWIO_LPASS_SB_BAM_P_RST6_ADDR A:0x6779d004
y.create.l HWIO_LPASS_SB_BAM_P_RST7_ADDR A:0x6779e004
y.create.l HWIO_LPASS_SB_BAM_P_RST8_ADDR A:0x6779f004
y.create.l HWIO_LPASS_SB_BAM_P_RST9_ADDR A:0x677a0004
y.create.l HWIO_LPASS_SB_BAM_P_HALT0_ADDR A:0x67797008
y.create.l HWIO_LPASS_SB_BAM_P_HALT1_ADDR A:0x67798008
y.create.l HWIO_LPASS_SB_BAM_P_HALT2_ADDR A:0x67799008
y.create.l HWIO_LPASS_SB_BAM_P_HALT3_ADDR A:0x6779a008
y.create.l HWIO_LPASS_SB_BAM_P_HALT4_ADDR A:0x6779b008
y.create.l HWIO_LPASS_SB_BAM_P_HALT5_ADDR A:0x6779c008
y.create.l HWIO_LPASS_SB_BAM_P_HALT6_ADDR A:0x6779d008
y.create.l HWIO_LPASS_SB_BAM_P_HALT7_ADDR A:0x6779e008
y.create.l HWIO_LPASS_SB_BAM_P_HALT8_ADDR A:0x6779f008
y.create.l HWIO_LPASS_SB_BAM_P_HALT9_ADDR A:0x677a0008
y.create.l HWIO_LPASS_SB_BAM_P_IRQ_STTS0_ADDR A:0x67797010
y.create.l HWIO_LPASS_SB_BAM_P_IRQ_STTS1_ADDR A:0x67798010
y.create.l HWIO_LPASS_SB_BAM_P_IRQ_STTS2_ADDR A:0x67799010
y.create.l HWIO_LPASS_SB_BAM_P_IRQ_STTS3_ADDR A:0x6779a010
y.create.l HWIO_LPASS_SB_BAM_P_IRQ_STTS4_ADDR A:0x6779b010
y.create.l HWIO_LPASS_SB_BAM_P_IRQ_STTS5_ADDR A:0x6779c010
y.create.l HWIO_LPASS_SB_BAM_P_IRQ_STTS6_ADDR A:0x6779d010
y.create.l HWIO_LPASS_SB_BAM_P_IRQ_STTS7_ADDR A:0x6779e010
y.create.l HWIO_LPASS_SB_BAM_P_IRQ_STTS8_ADDR A:0x6779f010
y.create.l HWIO_LPASS_SB_BAM_P_IRQ_STTS9_ADDR A:0x677a0010
y.create.l HWIO_LPASS_SB_BAM_P_IRQ_CLR0_ADDR A:0x67797014
y.create.l HWIO_LPASS_SB_BAM_P_IRQ_CLR1_ADDR A:0x67798014
y.create.l HWIO_LPASS_SB_BAM_P_IRQ_CLR2_ADDR A:0x67799014
y.create.l HWIO_LPASS_SB_BAM_P_IRQ_CLR3_ADDR A:0x6779a014
y.create.l HWIO_LPASS_SB_BAM_P_IRQ_CLR4_ADDR A:0x6779b014
y.create.l HWIO_LPASS_SB_BAM_P_IRQ_CLR5_ADDR A:0x6779c014
y.create.l HWIO_LPASS_SB_BAM_P_IRQ_CLR6_ADDR A:0x6779d014
y.create.l HWIO_LPASS_SB_BAM_P_IRQ_CLR7_ADDR A:0x6779e014
y.create.l HWIO_LPASS_SB_BAM_P_IRQ_CLR8_ADDR A:0x6779f014
y.create.l HWIO_LPASS_SB_BAM_P_IRQ_CLR9_ADDR A:0x677a0014
y.create.l HWIO_LPASS_SB_BAM_P_IRQ_EN0_ADDR A:0x67797018
y.create.l HWIO_LPASS_SB_BAM_P_IRQ_EN1_ADDR A:0x67798018
y.create.l HWIO_LPASS_SB_BAM_P_IRQ_EN2_ADDR A:0x67799018
y.create.l HWIO_LPASS_SB_BAM_P_IRQ_EN3_ADDR A:0x6779a018
y.create.l HWIO_LPASS_SB_BAM_P_IRQ_EN4_ADDR A:0x6779b018
y.create.l HWIO_LPASS_SB_BAM_P_IRQ_EN5_ADDR A:0x6779c018
y.create.l HWIO_LPASS_SB_BAM_P_IRQ_EN6_ADDR A:0x6779d018
y.create.l HWIO_LPASS_SB_BAM_P_IRQ_EN7_ADDR A:0x6779e018
y.create.l HWIO_LPASS_SB_BAM_P_IRQ_EN8_ADDR A:0x6779f018
y.create.l HWIO_LPASS_SB_BAM_P_IRQ_EN9_ADDR A:0x677a0018
y.create.l HWIO_LPASS_SB_BAM_P_TIMER0_ADDR A:0x6779701c
y.create.l HWIO_LPASS_SB_BAM_P_TIMER1_ADDR A:0x6779801c
y.create.l HWIO_LPASS_SB_BAM_P_TIMER2_ADDR A:0x6779901c
y.create.l HWIO_LPASS_SB_BAM_P_TIMER3_ADDR A:0x6779a01c
y.create.l HWIO_LPASS_SB_BAM_P_TIMER4_ADDR A:0x6779b01c
y.create.l HWIO_LPASS_SB_BAM_P_TIMER5_ADDR A:0x6779c01c
y.create.l HWIO_LPASS_SB_BAM_P_TIMER6_ADDR A:0x6779d01c
y.create.l HWIO_LPASS_SB_BAM_P_TIMER7_ADDR A:0x6779e01c
y.create.l HWIO_LPASS_SB_BAM_P_TIMER8_ADDR A:0x6779f01c
y.create.l HWIO_LPASS_SB_BAM_P_TIMER9_ADDR A:0x677a001c
y.create.l HWIO_LPASS_SB_BAM_P_TIMER_CTRL0_ADDR A:0x67797020
y.create.l HWIO_LPASS_SB_BAM_P_TIMER_CTRL1_ADDR A:0x67798020
y.create.l HWIO_LPASS_SB_BAM_P_TIMER_CTRL2_ADDR A:0x67799020
y.create.l HWIO_LPASS_SB_BAM_P_TIMER_CTRL3_ADDR A:0x6779a020
y.create.l HWIO_LPASS_SB_BAM_P_TIMER_CTRL4_ADDR A:0x6779b020
y.create.l HWIO_LPASS_SB_BAM_P_TIMER_CTRL5_ADDR A:0x6779c020
y.create.l HWIO_LPASS_SB_BAM_P_TIMER_CTRL6_ADDR A:0x6779d020
y.create.l HWIO_LPASS_SB_BAM_P_TIMER_CTRL7_ADDR A:0x6779e020
y.create.l HWIO_LPASS_SB_BAM_P_TIMER_CTRL8_ADDR A:0x6779f020
y.create.l HWIO_LPASS_SB_BAM_P_TIMER_CTRL9_ADDR A:0x677a0020
y.create.l HWIO_LPASS_SB_BAM_P_PRDCR_SDBND0_ADDR A:0x67797024
y.create.l HWIO_LPASS_SB_BAM_P_PRDCR_SDBND1_ADDR A:0x67798024
y.create.l HWIO_LPASS_SB_BAM_P_PRDCR_SDBND2_ADDR A:0x67799024
y.create.l HWIO_LPASS_SB_BAM_P_PRDCR_SDBND3_ADDR A:0x6779a024
y.create.l HWIO_LPASS_SB_BAM_P_PRDCR_SDBND4_ADDR A:0x6779b024
y.create.l HWIO_LPASS_SB_BAM_P_PRDCR_SDBND5_ADDR A:0x6779c024
y.create.l HWIO_LPASS_SB_BAM_P_PRDCR_SDBND6_ADDR A:0x6779d024
y.create.l HWIO_LPASS_SB_BAM_P_PRDCR_SDBND7_ADDR A:0x6779e024
y.create.l HWIO_LPASS_SB_BAM_P_PRDCR_SDBND8_ADDR A:0x6779f024
y.create.l HWIO_LPASS_SB_BAM_P_PRDCR_SDBND9_ADDR A:0x677a0024
y.create.l HWIO_LPASS_SB_BAM_P_CNSMR_SDBND0_ADDR A:0x67797028
y.create.l HWIO_LPASS_SB_BAM_P_CNSMR_SDBND1_ADDR A:0x67798028
y.create.l HWIO_LPASS_SB_BAM_P_CNSMR_SDBND2_ADDR A:0x67799028
y.create.l HWIO_LPASS_SB_BAM_P_CNSMR_SDBND3_ADDR A:0x6779a028
y.create.l HWIO_LPASS_SB_BAM_P_CNSMR_SDBND4_ADDR A:0x6779b028
y.create.l HWIO_LPASS_SB_BAM_P_CNSMR_SDBND5_ADDR A:0x6779c028
y.create.l HWIO_LPASS_SB_BAM_P_CNSMR_SDBND6_ADDR A:0x6779d028
y.create.l HWIO_LPASS_SB_BAM_P_CNSMR_SDBND7_ADDR A:0x6779e028
y.create.l HWIO_LPASS_SB_BAM_P_CNSMR_SDBND8_ADDR A:0x6779f028
y.create.l HWIO_LPASS_SB_BAM_P_CNSMR_SDBND9_ADDR A:0x677a0028
y.create.l HWIO_LPASS_SB_BAM_P_SW_OFSTS0_ADDR A:0x67797800
y.create.l HWIO_LPASS_SB_BAM_P_SW_OFSTS1_ADDR A:0x67798800
y.create.l HWIO_LPASS_SB_BAM_P_SW_OFSTS2_ADDR A:0x67799800
y.create.l HWIO_LPASS_SB_BAM_P_SW_OFSTS3_ADDR A:0x6779a800
y.create.l HWIO_LPASS_SB_BAM_P_SW_OFSTS4_ADDR A:0x6779b800
y.create.l HWIO_LPASS_SB_BAM_P_SW_OFSTS5_ADDR A:0x6779c800
y.create.l HWIO_LPASS_SB_BAM_P_SW_OFSTS6_ADDR A:0x6779d800
y.create.l HWIO_LPASS_SB_BAM_P_SW_OFSTS7_ADDR A:0x6779e800
y.create.l HWIO_LPASS_SB_BAM_P_SW_OFSTS8_ADDR A:0x6779f800
y.create.l HWIO_LPASS_SB_BAM_P_SW_OFSTS9_ADDR A:0x677a0800
y.create.l HWIO_LPASS_SB_BAM_P_AU_PSM_CNTXT_1_0_ADDR A:0x67797804
y.create.l HWIO_LPASS_SB_BAM_P_AU_PSM_CNTXT_1_1_ADDR A:0x67798804
y.create.l HWIO_LPASS_SB_BAM_P_AU_PSM_CNTXT_1_2_ADDR A:0x67799804
y.create.l HWIO_LPASS_SB_BAM_P_AU_PSM_CNTXT_1_3_ADDR A:0x6779a804
y.create.l HWIO_LPASS_SB_BAM_P_AU_PSM_CNTXT_1_4_ADDR A:0x6779b804
y.create.l HWIO_LPASS_SB_BAM_P_AU_PSM_CNTXT_1_5_ADDR A:0x6779c804
y.create.l HWIO_LPASS_SB_BAM_P_AU_PSM_CNTXT_1_6_ADDR A:0x6779d804
y.create.l HWIO_LPASS_SB_BAM_P_AU_PSM_CNTXT_1_7_ADDR A:0x6779e804
y.create.l HWIO_LPASS_SB_BAM_P_AU_PSM_CNTXT_1_8_ADDR A:0x6779f804
y.create.l HWIO_LPASS_SB_BAM_P_AU_PSM_CNTXT_1_9_ADDR A:0x677a0804
y.create.l HWIO_LPASS_SB_BAM_P_PSM_CNTXT_2_0_ADDR A:0x67797808
y.create.l HWIO_LPASS_SB_BAM_P_PSM_CNTXT_2_1_ADDR A:0x67798808
y.create.l HWIO_LPASS_SB_BAM_P_PSM_CNTXT_2_2_ADDR A:0x67799808
y.create.l HWIO_LPASS_SB_BAM_P_PSM_CNTXT_2_3_ADDR A:0x6779a808
y.create.l HWIO_LPASS_SB_BAM_P_PSM_CNTXT_2_4_ADDR A:0x6779b808
y.create.l HWIO_LPASS_SB_BAM_P_PSM_CNTXT_2_5_ADDR A:0x6779c808
y.create.l HWIO_LPASS_SB_BAM_P_PSM_CNTXT_2_6_ADDR A:0x6779d808
y.create.l HWIO_LPASS_SB_BAM_P_PSM_CNTXT_2_7_ADDR A:0x6779e808
y.create.l HWIO_LPASS_SB_BAM_P_PSM_CNTXT_2_8_ADDR A:0x6779f808
y.create.l HWIO_LPASS_SB_BAM_P_PSM_CNTXT_2_9_ADDR A:0x677a0808
y.create.l HWIO_LPASS_SB_BAM_P_PSM_CNTXT_3_0_ADDR A:0x6779780c
y.create.l HWIO_LPASS_SB_BAM_P_PSM_CNTXT_3_1_ADDR A:0x6779880c
y.create.l HWIO_LPASS_SB_BAM_P_PSM_CNTXT_3_2_ADDR A:0x6779980c
y.create.l HWIO_LPASS_SB_BAM_P_PSM_CNTXT_3_3_ADDR A:0x6779a80c
y.create.l HWIO_LPASS_SB_BAM_P_PSM_CNTXT_3_4_ADDR A:0x6779b80c
y.create.l HWIO_LPASS_SB_BAM_P_PSM_CNTXT_3_5_ADDR A:0x6779c80c
y.create.l HWIO_LPASS_SB_BAM_P_PSM_CNTXT_3_6_ADDR A:0x6779d80c
y.create.l HWIO_LPASS_SB_BAM_P_PSM_CNTXT_3_7_ADDR A:0x6779e80c
y.create.l HWIO_LPASS_SB_BAM_P_PSM_CNTXT_3_8_ADDR A:0x6779f80c
y.create.l HWIO_LPASS_SB_BAM_P_PSM_CNTXT_3_9_ADDR A:0x677a080c
y.create.l HWIO_LPASS_SB_BAM_P_PSM_CNTXT_4_0_ADDR A:0x67797810
y.create.l HWIO_LPASS_SB_BAM_P_PSM_CNTXT_4_1_ADDR A:0x67798810
y.create.l HWIO_LPASS_SB_BAM_P_PSM_CNTXT_4_2_ADDR A:0x67799810
y.create.l HWIO_LPASS_SB_BAM_P_PSM_CNTXT_4_3_ADDR A:0x6779a810
y.create.l HWIO_LPASS_SB_BAM_P_PSM_CNTXT_4_4_ADDR A:0x6779b810
y.create.l HWIO_LPASS_SB_BAM_P_PSM_CNTXT_4_5_ADDR A:0x6779c810
y.create.l HWIO_LPASS_SB_BAM_P_PSM_CNTXT_4_6_ADDR A:0x6779d810
y.create.l HWIO_LPASS_SB_BAM_P_PSM_CNTXT_4_7_ADDR A:0x6779e810
y.create.l HWIO_LPASS_SB_BAM_P_PSM_CNTXT_4_8_ADDR A:0x6779f810
y.create.l HWIO_LPASS_SB_BAM_P_PSM_CNTXT_4_9_ADDR A:0x677a0810
y.create.l HWIO_LPASS_SB_BAM_P_PSM_CNTXT_5_0_ADDR A:0x67797814
y.create.l HWIO_LPASS_SB_BAM_P_PSM_CNTXT_5_1_ADDR A:0x67798814
y.create.l HWIO_LPASS_SB_BAM_P_PSM_CNTXT_5_2_ADDR A:0x67799814
y.create.l HWIO_LPASS_SB_BAM_P_PSM_CNTXT_5_3_ADDR A:0x6779a814
y.create.l HWIO_LPASS_SB_BAM_P_PSM_CNTXT_5_4_ADDR A:0x6779b814
y.create.l HWIO_LPASS_SB_BAM_P_PSM_CNTXT_5_5_ADDR A:0x6779c814
y.create.l HWIO_LPASS_SB_BAM_P_PSM_CNTXT_5_6_ADDR A:0x6779d814
y.create.l HWIO_LPASS_SB_BAM_P_PSM_CNTXT_5_7_ADDR A:0x6779e814
y.create.l HWIO_LPASS_SB_BAM_P_PSM_CNTXT_5_8_ADDR A:0x6779f814
y.create.l HWIO_LPASS_SB_BAM_P_PSM_CNTXT_5_9_ADDR A:0x677a0814
y.create.l HWIO_LPASS_SB_BAM_P_EVNT_REG0_ADDR A:0x67797818
y.create.l HWIO_LPASS_SB_BAM_P_EVNT_REG1_ADDR A:0x67798818
y.create.l HWIO_LPASS_SB_BAM_P_EVNT_REG2_ADDR A:0x67799818
y.create.l HWIO_LPASS_SB_BAM_P_EVNT_REG3_ADDR A:0x6779a818
y.create.l HWIO_LPASS_SB_BAM_P_EVNT_REG4_ADDR A:0x6779b818
y.create.l HWIO_LPASS_SB_BAM_P_EVNT_REG5_ADDR A:0x6779c818
y.create.l HWIO_LPASS_SB_BAM_P_EVNT_REG6_ADDR A:0x6779d818
y.create.l HWIO_LPASS_SB_BAM_P_EVNT_REG7_ADDR A:0x6779e818
y.create.l HWIO_LPASS_SB_BAM_P_EVNT_REG8_ADDR A:0x6779f818
y.create.l HWIO_LPASS_SB_BAM_P_EVNT_REG9_ADDR A:0x677a0818
y.create.l HWIO_LPASS_SB_BAM_P_DESC_FIFO_ADDR0_ADDR A:0x6779781c
y.create.l HWIO_LPASS_SB_BAM_P_DESC_FIFO_ADDR1_ADDR A:0x6779881c
y.create.l HWIO_LPASS_SB_BAM_P_DESC_FIFO_ADDR2_ADDR A:0x6779981c
y.create.l HWIO_LPASS_SB_BAM_P_DESC_FIFO_ADDR3_ADDR A:0x6779a81c
y.create.l HWIO_LPASS_SB_BAM_P_DESC_FIFO_ADDR4_ADDR A:0x6779b81c
y.create.l HWIO_LPASS_SB_BAM_P_DESC_FIFO_ADDR5_ADDR A:0x6779c81c
y.create.l HWIO_LPASS_SB_BAM_P_DESC_FIFO_ADDR6_ADDR A:0x6779d81c
y.create.l HWIO_LPASS_SB_BAM_P_DESC_FIFO_ADDR7_ADDR A:0x6779e81c
y.create.l HWIO_LPASS_SB_BAM_P_DESC_FIFO_ADDR8_ADDR A:0x6779f81c
y.create.l HWIO_LPASS_SB_BAM_P_DESC_FIFO_ADDR9_ADDR A:0x677a081c
y.create.l HWIO_LPASS_SB_BAM_P_FIFO_SIZES0_ADDR A:0x67797820
y.create.l HWIO_LPASS_SB_BAM_P_FIFO_SIZES1_ADDR A:0x67798820
y.create.l HWIO_LPASS_SB_BAM_P_FIFO_SIZES2_ADDR A:0x67799820
y.create.l HWIO_LPASS_SB_BAM_P_FIFO_SIZES3_ADDR A:0x6779a820
y.create.l HWIO_LPASS_SB_BAM_P_FIFO_SIZES4_ADDR A:0x6779b820
y.create.l HWIO_LPASS_SB_BAM_P_FIFO_SIZES5_ADDR A:0x6779c820
y.create.l HWIO_LPASS_SB_BAM_P_FIFO_SIZES6_ADDR A:0x6779d820
y.create.l HWIO_LPASS_SB_BAM_P_FIFO_SIZES7_ADDR A:0x6779e820
y.create.l HWIO_LPASS_SB_BAM_P_FIFO_SIZES8_ADDR A:0x6779f820
y.create.l HWIO_LPASS_SB_BAM_P_FIFO_SIZES9_ADDR A:0x677a0820
y.create.l HWIO_LPASS_SB_BAM_P_DATA_FIFO_ADDR0_ADDR A:0x67797824
y.create.l HWIO_LPASS_SB_BAM_P_DATA_FIFO_ADDR1_ADDR A:0x67798824
y.create.l HWIO_LPASS_SB_BAM_P_DATA_FIFO_ADDR2_ADDR A:0x67799824
y.create.l HWIO_LPASS_SB_BAM_P_DATA_FIFO_ADDR3_ADDR A:0x6779a824
y.create.l HWIO_LPASS_SB_BAM_P_DATA_FIFO_ADDR4_ADDR A:0x6779b824
y.create.l HWIO_LPASS_SB_BAM_P_DATA_FIFO_ADDR5_ADDR A:0x6779c824
y.create.l HWIO_LPASS_SB_BAM_P_DATA_FIFO_ADDR6_ADDR A:0x6779d824
y.create.l HWIO_LPASS_SB_BAM_P_DATA_FIFO_ADDR7_ADDR A:0x6779e824
y.create.l HWIO_LPASS_SB_BAM_P_DATA_FIFO_ADDR8_ADDR A:0x6779f824
y.create.l HWIO_LPASS_SB_BAM_P_DATA_FIFO_ADDR9_ADDR A:0x677a0824
y.create.l HWIO_LPASS_SB_BAM_P_EVNT_GEN_TRSHLD0_ADDR A:0x67797828
y.create.l HWIO_LPASS_SB_BAM_P_EVNT_GEN_TRSHLD1_ADDR A:0x67798828
y.create.l HWIO_LPASS_SB_BAM_P_EVNT_GEN_TRSHLD2_ADDR A:0x67799828
y.create.l HWIO_LPASS_SB_BAM_P_EVNT_GEN_TRSHLD3_ADDR A:0x6779a828
y.create.l HWIO_LPASS_SB_BAM_P_EVNT_GEN_TRSHLD4_ADDR A:0x6779b828
y.create.l HWIO_LPASS_SB_BAM_P_EVNT_GEN_TRSHLD5_ADDR A:0x6779c828
y.create.l HWIO_LPASS_SB_BAM_P_EVNT_GEN_TRSHLD6_ADDR A:0x6779d828
y.create.l HWIO_LPASS_SB_BAM_P_EVNT_GEN_TRSHLD7_ADDR A:0x6779e828
y.create.l HWIO_LPASS_SB_BAM_P_EVNT_GEN_TRSHLD8_ADDR A:0x6779f828
y.create.l HWIO_LPASS_SB_BAM_P_EVNT_GEN_TRSHLD9_ADDR A:0x677a0828
y.create.l HWIO_LPASS_SB_BAM_P_EVNT_DEST_ADDR0_ADDR A:0x6779782c
y.create.l HWIO_LPASS_SB_BAM_P_EVNT_DEST_ADDR1_ADDR A:0x6779882c
y.create.l HWIO_LPASS_SB_BAM_P_EVNT_DEST_ADDR2_ADDR A:0x6779982c
y.create.l HWIO_LPASS_SB_BAM_P_EVNT_DEST_ADDR3_ADDR A:0x6779a82c
y.create.l HWIO_LPASS_SB_BAM_P_EVNT_DEST_ADDR4_ADDR A:0x6779b82c
y.create.l HWIO_LPASS_SB_BAM_P_EVNT_DEST_ADDR5_ADDR A:0x6779c82c
y.create.l HWIO_LPASS_SB_BAM_P_EVNT_DEST_ADDR6_ADDR A:0x6779d82c
y.create.l HWIO_LPASS_SB_BAM_P_EVNT_DEST_ADDR7_ADDR A:0x6779e82c
y.create.l HWIO_LPASS_SB_BAM_P_EVNT_DEST_ADDR8_ADDR A:0x6779f82c
y.create.l HWIO_LPASS_SB_BAM_P_EVNT_DEST_ADDR9_ADDR A:0x677a082c
y.create.l HWIO_LPASS_SB_BAM_P_DF_CNTXT_0_ADDR A:0x67797830
y.create.l HWIO_LPASS_SB_BAM_P_DF_CNTXT_1_ADDR A:0x67798830
y.create.l HWIO_LPASS_SB_BAM_P_DF_CNTXT_2_ADDR A:0x67799830
y.create.l HWIO_LPASS_SB_BAM_P_DF_CNTXT_3_ADDR A:0x6779a830
y.create.l HWIO_LPASS_SB_BAM_P_DF_CNTXT_4_ADDR A:0x6779b830
y.create.l HWIO_LPASS_SB_BAM_P_DF_CNTXT_5_ADDR A:0x6779c830
y.create.l HWIO_LPASS_SB_BAM_P_DF_CNTXT_6_ADDR A:0x6779d830
y.create.l HWIO_LPASS_SB_BAM_P_DF_CNTXT_7_ADDR A:0x6779e830
y.create.l HWIO_LPASS_SB_BAM_P_DF_CNTXT_8_ADDR A:0x6779f830
y.create.l HWIO_LPASS_SB_BAM_P_DF_CNTXT_9_ADDR A:0x677a0830
y.create.l HWIO_LPASS_SB_BAM_P_RETR_CNTXT_0_ADDR A:0x67797834
y.create.l HWIO_LPASS_SB_BAM_P_RETR_CNTXT_1_ADDR A:0x67798834
y.create.l HWIO_LPASS_SB_BAM_P_RETR_CNTXT_2_ADDR A:0x67799834
y.create.l HWIO_LPASS_SB_BAM_P_RETR_CNTXT_3_ADDR A:0x6779a834
y.create.l HWIO_LPASS_SB_BAM_P_RETR_CNTXT_4_ADDR A:0x6779b834
y.create.l HWIO_LPASS_SB_BAM_P_RETR_CNTXT_5_ADDR A:0x6779c834
y.create.l HWIO_LPASS_SB_BAM_P_RETR_CNTXT_6_ADDR A:0x6779d834
y.create.l HWIO_LPASS_SB_BAM_P_RETR_CNTXT_7_ADDR A:0x6779e834
y.create.l HWIO_LPASS_SB_BAM_P_RETR_CNTXT_8_ADDR A:0x6779f834
y.create.l HWIO_LPASS_SB_BAM_P_RETR_CNTXT_9_ADDR A:0x677a0834
y.create.l HWIO_LPASS_SB_BAM_P_SI_CNTXT_0_ADDR A:0x67797838
y.create.l HWIO_LPASS_SB_BAM_P_SI_CNTXT_1_ADDR A:0x67798838
y.create.l HWIO_LPASS_SB_BAM_P_SI_CNTXT_2_ADDR A:0x67799838
y.create.l HWIO_LPASS_SB_BAM_P_SI_CNTXT_3_ADDR A:0x6779a838
y.create.l HWIO_LPASS_SB_BAM_P_SI_CNTXT_4_ADDR A:0x6779b838
y.create.l HWIO_LPASS_SB_BAM_P_SI_CNTXT_5_ADDR A:0x6779c838
y.create.l HWIO_LPASS_SB_BAM_P_SI_CNTXT_6_ADDR A:0x6779d838
y.create.l HWIO_LPASS_SB_BAM_P_SI_CNTXT_7_ADDR A:0x6779e838
y.create.l HWIO_LPASS_SB_BAM_P_SI_CNTXT_8_ADDR A:0x6779f838
y.create.l HWIO_LPASS_SB_BAM_P_SI_CNTXT_9_ADDR A:0x677a0838
y.create.l HWIO_LPASS_SB_BAM_P_PSM_CNTXT_3_LSB0_ADDR A:0x67797900
y.create.l HWIO_LPASS_SB_BAM_P_PSM_CNTXT_3_LSB1_ADDR A:0x67798900
y.create.l HWIO_LPASS_SB_BAM_P_PSM_CNTXT_3_LSB2_ADDR A:0x67799900
y.create.l HWIO_LPASS_SB_BAM_P_PSM_CNTXT_3_LSB3_ADDR A:0x6779a900
y.create.l HWIO_LPASS_SB_BAM_P_PSM_CNTXT_3_LSB4_ADDR A:0x6779b900
y.create.l HWIO_LPASS_SB_BAM_P_PSM_CNTXT_3_LSB5_ADDR A:0x6779c900
y.create.l HWIO_LPASS_SB_BAM_P_PSM_CNTXT_3_LSB6_ADDR A:0x6779d900
y.create.l HWIO_LPASS_SB_BAM_P_PSM_CNTXT_3_LSB7_ADDR A:0x6779e900
y.create.l HWIO_LPASS_SB_BAM_P_PSM_CNTXT_3_LSB8_ADDR A:0x6779f900
y.create.l HWIO_LPASS_SB_BAM_P_PSM_CNTXT_3_LSB9_ADDR A:0x677a0900
y.create.l HWIO_LPASS_SB_BAM_P_PSM_CNTXT_3_MSB0_ADDR A:0x67797904
y.create.l HWIO_LPASS_SB_BAM_P_PSM_CNTXT_3_MSB1_ADDR A:0x67798904
y.create.l HWIO_LPASS_SB_BAM_P_PSM_CNTXT_3_MSB2_ADDR A:0x67799904
y.create.l HWIO_LPASS_SB_BAM_P_PSM_CNTXT_3_MSB3_ADDR A:0x6779a904
y.create.l HWIO_LPASS_SB_BAM_P_PSM_CNTXT_3_MSB4_ADDR A:0x6779b904
y.create.l HWIO_LPASS_SB_BAM_P_PSM_CNTXT_3_MSB5_ADDR A:0x6779c904
y.create.l HWIO_LPASS_SB_BAM_P_PSM_CNTXT_3_MSB6_ADDR A:0x6779d904
y.create.l HWIO_LPASS_SB_BAM_P_PSM_CNTXT_3_MSB7_ADDR A:0x6779e904
y.create.l HWIO_LPASS_SB_BAM_P_PSM_CNTXT_3_MSB8_ADDR A:0x6779f904
y.create.l HWIO_LPASS_SB_BAM_P_PSM_CNTXT_3_MSB9_ADDR A:0x677a0904
y.create.l HWIO_LPASS_SB_BAM_P_DESC_FIFO_ADDR_LSB0_ADDR A:0x67797910
y.create.l HWIO_LPASS_SB_BAM_P_DESC_FIFO_ADDR_LSB1_ADDR A:0x67798910
y.create.l HWIO_LPASS_SB_BAM_P_DESC_FIFO_ADDR_LSB2_ADDR A:0x67799910
y.create.l HWIO_LPASS_SB_BAM_P_DESC_FIFO_ADDR_LSB3_ADDR A:0x6779a910
y.create.l HWIO_LPASS_SB_BAM_P_DESC_FIFO_ADDR_LSB4_ADDR A:0x6779b910
y.create.l HWIO_LPASS_SB_BAM_P_DESC_FIFO_ADDR_LSB5_ADDR A:0x6779c910
y.create.l HWIO_LPASS_SB_BAM_P_DESC_FIFO_ADDR_LSB6_ADDR A:0x6779d910
y.create.l HWIO_LPASS_SB_BAM_P_DESC_FIFO_ADDR_LSB7_ADDR A:0x6779e910
y.create.l HWIO_LPASS_SB_BAM_P_DESC_FIFO_ADDR_LSB8_ADDR A:0x6779f910
y.create.l HWIO_LPASS_SB_BAM_P_DESC_FIFO_ADDR_LSB9_ADDR A:0x677a0910
y.create.l HWIO_LPASS_SB_BAM_P_DESC_FIFO_ADDR_MSB0_ADDR A:0x67797914
y.create.l HWIO_LPASS_SB_BAM_P_DESC_FIFO_ADDR_MSB1_ADDR A:0x67798914
y.create.l HWIO_LPASS_SB_BAM_P_DESC_FIFO_ADDR_MSB2_ADDR A:0x67799914
y.create.l HWIO_LPASS_SB_BAM_P_DESC_FIFO_ADDR_MSB3_ADDR A:0x6779a914
y.create.l HWIO_LPASS_SB_BAM_P_DESC_FIFO_ADDR_MSB4_ADDR A:0x6779b914
y.create.l HWIO_LPASS_SB_BAM_P_DESC_FIFO_ADDR_MSB5_ADDR A:0x6779c914
y.create.l HWIO_LPASS_SB_BAM_P_DESC_FIFO_ADDR_MSB6_ADDR A:0x6779d914
y.create.l HWIO_LPASS_SB_BAM_P_DESC_FIFO_ADDR_MSB7_ADDR A:0x6779e914
y.create.l HWIO_LPASS_SB_BAM_P_DESC_FIFO_ADDR_MSB8_ADDR A:0x6779f914
y.create.l HWIO_LPASS_SB_BAM_P_DESC_FIFO_ADDR_MSB9_ADDR A:0x677a0914
y.create.l HWIO_LPASS_SB_BAM_P_DATA_FIFO_ADDR_LSB0_ADDR A:0x67797920
y.create.l HWIO_LPASS_SB_BAM_P_DATA_FIFO_ADDR_LSB1_ADDR A:0x67798920
y.create.l HWIO_LPASS_SB_BAM_P_DATA_FIFO_ADDR_LSB2_ADDR A:0x67799920
y.create.l HWIO_LPASS_SB_BAM_P_DATA_FIFO_ADDR_LSB3_ADDR A:0x6779a920
y.create.l HWIO_LPASS_SB_BAM_P_DATA_FIFO_ADDR_LSB4_ADDR A:0x6779b920
y.create.l HWIO_LPASS_SB_BAM_P_DATA_FIFO_ADDR_LSB5_ADDR A:0x6779c920
y.create.l HWIO_LPASS_SB_BAM_P_DATA_FIFO_ADDR_LSB6_ADDR A:0x6779d920
y.create.l HWIO_LPASS_SB_BAM_P_DATA_FIFO_ADDR_LSB7_ADDR A:0x6779e920
y.create.l HWIO_LPASS_SB_BAM_P_DATA_FIFO_ADDR_LSB8_ADDR A:0x6779f920
y.create.l HWIO_LPASS_SB_BAM_P_DATA_FIFO_ADDR_LSB9_ADDR A:0x677a0920
y.create.l HWIO_LPASS_SB_BAM_P_DATA_FIFO_ADDR_MSB0_ADDR A:0x67797924
y.create.l HWIO_LPASS_SB_BAM_P_DATA_FIFO_ADDR_MSB1_ADDR A:0x67798924
y.create.l HWIO_LPASS_SB_BAM_P_DATA_FIFO_ADDR_MSB2_ADDR A:0x67799924
y.create.l HWIO_LPASS_SB_BAM_P_DATA_FIFO_ADDR_MSB3_ADDR A:0x6779a924
y.create.l HWIO_LPASS_SB_BAM_P_DATA_FIFO_ADDR_MSB4_ADDR A:0x6779b924
y.create.l HWIO_LPASS_SB_BAM_P_DATA_FIFO_ADDR_MSB5_ADDR A:0x6779c924
y.create.l HWIO_LPASS_SB_BAM_P_DATA_FIFO_ADDR_MSB6_ADDR A:0x6779d924
y.create.l HWIO_LPASS_SB_BAM_P_DATA_FIFO_ADDR_MSB7_ADDR A:0x6779e924
y.create.l HWIO_LPASS_SB_BAM_P_DATA_FIFO_ADDR_MSB8_ADDR A:0x6779f924
y.create.l HWIO_LPASS_SB_BAM_P_DATA_FIFO_ADDR_MSB9_ADDR A:0x677a0924
y.create.l HWIO_LPASS_SB_BAM_P_EVNT_DEST_ADDR_LSB0_ADDR A:0x67797930
y.create.l HWIO_LPASS_SB_BAM_P_EVNT_DEST_ADDR_LSB1_ADDR A:0x67798930
y.create.l HWIO_LPASS_SB_BAM_P_EVNT_DEST_ADDR_LSB2_ADDR A:0x67799930
y.create.l HWIO_LPASS_SB_BAM_P_EVNT_DEST_ADDR_LSB3_ADDR A:0x6779a930
y.create.l HWIO_LPASS_SB_BAM_P_EVNT_DEST_ADDR_LSB4_ADDR A:0x6779b930
y.create.l HWIO_LPASS_SB_BAM_P_EVNT_DEST_ADDR_LSB5_ADDR A:0x6779c930
y.create.l HWIO_LPASS_SB_BAM_P_EVNT_DEST_ADDR_LSB6_ADDR A:0x6779d930
y.create.l HWIO_LPASS_SB_BAM_P_EVNT_DEST_ADDR_LSB7_ADDR A:0x6779e930
y.create.l HWIO_LPASS_SB_BAM_P_EVNT_DEST_ADDR_LSB8_ADDR A:0x6779f930
y.create.l HWIO_LPASS_SB_BAM_P_EVNT_DEST_ADDR_LSB9_ADDR A:0x677a0930
y.create.l HWIO_LPASS_SB_BAM_P_EVNT_DEST_ADDR_MSB0_ADDR A:0x67797934
y.create.l HWIO_LPASS_SB_BAM_P_EVNT_DEST_ADDR_MSB1_ADDR A:0x67798934
y.create.l HWIO_LPASS_SB_BAM_P_EVNT_DEST_ADDR_MSB2_ADDR A:0x67799934
y.create.l HWIO_LPASS_SB_BAM_P_EVNT_DEST_ADDR_MSB3_ADDR A:0x6779a934
y.create.l HWIO_LPASS_SB_BAM_P_EVNT_DEST_ADDR_MSB4_ADDR A:0x6779b934
y.create.l HWIO_LPASS_SB_BAM_P_EVNT_DEST_ADDR_MSB5_ADDR A:0x6779c934
y.create.l HWIO_LPASS_SB_BAM_P_EVNT_DEST_ADDR_MSB6_ADDR A:0x6779d934
y.create.l HWIO_LPASS_SB_BAM_P_EVNT_DEST_ADDR_MSB7_ADDR A:0x6779e934
y.create.l HWIO_LPASS_SB_BAM_P_EVNT_DEST_ADDR_MSB8_ADDR A:0x6779f934
y.create.l HWIO_LPASS_SB_BAM_P_EVNT_DEST_ADDR_MSB9_ADDR A:0x677a0934
y.create.l HWIO_LPASS_SB_COMP_HW_VERSION_ADDR A:0x677c0000
y.create.l HWIO_LPASS_SB_COMP_CFG_ADDR A:0x677c0004
y.create.l HWIO_LPASS_SB_SW_RESET_ADDR A:0x677c0008
y.create.l HWIO_LPASS_SB_COMP_POWER_CFG_ADDR A:0x677c000c
y.create.l HWIO_LPASS_SB_COMP_FEATURE_CFG_ADDR A:0x677c0010
y.create.l HWIO_LPASS_SB_COMP_STATUS_ADDR A:0x677c0020
y.create.l HWIO_LPASS_SB_COMP_PARAMS_ADDR A:0x677c0024
y.create.l HWIO_LPASS_SB_COMP_CHAR_CFG_ADDR A:0x677c0028
y.create.l HWIO_LPASS_SB_COMP_CHAR_DATA_0_ADDR A:0x677c002c
y.create.l HWIO_LPASS_SB_COMP_CHAR_DATA_1_ADDR A:0x677c0030
y.create.l HWIO_LPASS_SB_MGR_CFG_ADDR A:0x677c0200
y.create.l HWIO_LPASS_SB_MGR_STATUS_ADDR A:0x677c0204
y.create.l HWIO_LPASS_SB_MGR_RX_MSGQ_CFG_ADDR A:0x677c0208
y.create.l HWIO_LPASS_SB_MGR_INT_EN_ADDR A:0x677c0210
y.create.l HWIO_LPASS_SB_MGR_INT_STATUS_ADDR A:0x677c0214
y.create.l HWIO_LPASS_SB_MGR_INT_CLR_ADDR A:0x677c0218
y.create.l HWIO_LPASS_SB_MGR_TX_MSG0_ADDR A:0x677c0230
y.create.l HWIO_LPASS_SB_MGR_TX_MSG1_ADDR A:0x677c0234
y.create.l HWIO_LPASS_SB_MGR_TX_MSG2_ADDR A:0x677c0238
y.create.l HWIO_LPASS_SB_MGR_TX_MSG3_ADDR A:0x677c023c
y.create.l HWIO_LPASS_SB_MGR_TX_MSG4_ADDR A:0x677c0240
y.create.l HWIO_LPASS_SB_MGR_TX_MSG5_ADDR A:0x677c0244
y.create.l HWIO_LPASS_SB_MGR_TX_MSG6_ADDR A:0x677c0248
y.create.l HWIO_LPASS_SB_MGR_TX_MSG7_ADDR A:0x677c024c
y.create.l HWIO_LPASS_SB_MGR_TX_MSG8_ADDR A:0x677c0250
y.create.l HWIO_LPASS_SB_MGR_TX_MSG9_ADDR A:0x677c0254
y.create.l HWIO_LPASS_SB_MGR_RX_MSG0_ADDR A:0x677c0270
y.create.l HWIO_LPASS_SB_MGR_RX_MSG1_ADDR A:0x677c0274
y.create.l HWIO_LPASS_SB_MGR_RX_MSG2_ADDR A:0x677c0278
y.create.l HWIO_LPASS_SB_MGR_RX_MSG3_ADDR A:0x677c027c
y.create.l HWIO_LPASS_SB_MGR_RX_MSG4_ADDR A:0x677c0280
y.create.l HWIO_LPASS_SB_MGR_RX_MSG5_ADDR A:0x677c0284
y.create.l HWIO_LPASS_SB_MGR_RX_MSG6_ADDR A:0x677c0288
y.create.l HWIO_LPASS_SB_MGR_RX_MSG7_ADDR A:0x677c028c
y.create.l HWIO_LPASS_SB_MGR_RX_MSG8_ADDR A:0x677c0290
y.create.l HWIO_LPASS_SB_MGR_RX_MSG9_ADDR A:0x677c0294
y.create.l HWIO_LPASS_SB_MGR_IE_STATUS_ADDR A:0x677c02f0
y.create.l HWIO_LPASS_SB_MGR_VE_STATUS_ADDR A:0x677c0300
y.create.l HWIO_LPASS_SB_FRM_CFG_ADDR A:0x677c0400
y.create.l HWIO_LPASS_SB_FRM_STATUS_ADDR A:0x677c0404
y.create.l HWIO_LPASS_SB_FRM_INT_EN_ADDR A:0x677c0410
y.create.l HWIO_LPASS_SB_FRM_INT_STATUS_ADDR A:0x677c0414
y.create.l HWIO_LPASS_SB_FRM_INT_CLR_ADDR A:0x677c0418
y.create.l HWIO_LPASS_SB_FRM_WAKEUP_ADDR A:0x677c041c
y.create.l HWIO_LPASS_SB_FRM_CLKCTL_DONE_ADDR A:0x677c0420
y.create.l HWIO_LPASS_SB_FRM_IE_STATUS_ADDR A:0x677c0430
y.create.l HWIO_LPASS_SB_FRM_VE_STATUS_ADDR A:0x677c0440
y.create.l HWIO_LPASS_SB_INTF_CFG_ADDR A:0x677c0600
y.create.l HWIO_LPASS_SB_INTF_STATUS_ADDR A:0x677c0604
y.create.l HWIO_LPASS_SB_INTF_INT_EN_ADDR A:0x677c0610
y.create.l HWIO_LPASS_SB_INTF_INT_STATUS_ADDR A:0x677c0614
y.create.l HWIO_LPASS_SB_INTF_INT_CLR_ADDR A:0x677c0618
y.create.l HWIO_LPASS_SB_INTF_IE_STATUS_ADDR A:0x677c0630
y.create.l HWIO_LPASS_SB_INTF_VE_STATUS_ADDR A:0x677c0640
y.create.l HWIO_LPASS_SB_NGD1_CFG_ADDR A:0x677c1000
y.create.l HWIO_LPASS_SB_NGD1_STATUS_ADDR A:0x677c1004
y.create.l HWIO_LPASS_SB_NGD1_RX_MSGQ_CFG_ADDR A:0x677c1008
y.create.l HWIO_LPASS_SB_NGD1_INT_EN_ADDR A:0x677c1010
y.create.l HWIO_LPASS_SB_NGD1_INT_STATUS_ADDR A:0x677c1014
y.create.l HWIO_LPASS_SB_NGD1_INT_CLR_ADDR A:0x677c1018
y.create.l HWIO_LPASS_SB_NGD1_TX_MSG0_ADDR A:0x677c1030
y.create.l HWIO_LPASS_SB_NGD1_TX_MSG1_ADDR A:0x677c1034
y.create.l HWIO_LPASS_SB_NGD1_TX_MSG2_ADDR A:0x677c1038
y.create.l HWIO_LPASS_SB_NGD1_TX_MSG3_ADDR A:0x677c103c
y.create.l HWIO_LPASS_SB_NGD1_TX_MSG4_ADDR A:0x677c1040
y.create.l HWIO_LPASS_SB_NGD1_TX_MSG5_ADDR A:0x677c1044
y.create.l HWIO_LPASS_SB_NGD1_TX_MSG6_ADDR A:0x677c1048
y.create.l HWIO_LPASS_SB_NGD1_TX_MSG7_ADDR A:0x677c104c
y.create.l HWIO_LPASS_SB_NGD1_TX_MSG8_ADDR A:0x677c1050
y.create.l HWIO_LPASS_SB_NGD1_TX_MSG9_ADDR A:0x677c1054
y.create.l HWIO_LPASS_SB_NGD1_RX_MSG0_ADDR A:0x677c1070
y.create.l HWIO_LPASS_SB_NGD1_RX_MSG1_ADDR A:0x677c1074
y.create.l HWIO_LPASS_SB_NGD1_RX_MSG2_ADDR A:0x677c1078
y.create.l HWIO_LPASS_SB_NGD1_RX_MSG3_ADDR A:0x677c107c
y.create.l HWIO_LPASS_SB_NGD1_RX_MSG4_ADDR A:0x677c1080
y.create.l HWIO_LPASS_SB_NGD1_RX_MSG5_ADDR A:0x677c1084
y.create.l HWIO_LPASS_SB_NGD1_RX_MSG6_ADDR A:0x677c1088
y.create.l HWIO_LPASS_SB_NGD1_RX_MSG7_ADDR A:0x677c108c
y.create.l HWIO_LPASS_SB_NGD1_RX_MSG8_ADDR A:0x677c1090
y.create.l HWIO_LPASS_SB_NGD1_RX_MSG9_ADDR A:0x677c1094
y.create.l HWIO_LPASS_SB_NGD1_IE_STATUS_ADDR A:0x677c10f0
y.create.l HWIO_LPASS_SB_NGD1_VE_STATUS_ADDR A:0x677c1100
y.create.l HWIO_LPASS_SB_NGD2_CFG_ADDR A:0x677c2000
y.create.l HWIO_LPASS_SB_NGD2_STATUS_ADDR A:0x677c2004
y.create.l HWIO_LPASS_SB_NGD2_RX_MSGQ_CFG_ADDR A:0x677c2008
y.create.l HWIO_LPASS_SB_NGD2_INT_EN_ADDR A:0x677c2010
y.create.l HWIO_LPASS_SB_NGD2_INT_STATUS_ADDR A:0x677c2014
y.create.l HWIO_LPASS_SB_NGD2_INT_CLR_ADDR A:0x677c2018
y.create.l HWIO_LPASS_SB_NGD2_TX_MSG0_ADDR A:0x677c2030
y.create.l HWIO_LPASS_SB_NGD2_TX_MSG1_ADDR A:0x677c2034
y.create.l HWIO_LPASS_SB_NGD2_TX_MSG2_ADDR A:0x677c2038
y.create.l HWIO_LPASS_SB_NGD2_TX_MSG3_ADDR A:0x677c203c
y.create.l HWIO_LPASS_SB_NGD2_TX_MSG4_ADDR A:0x677c2040
y.create.l HWIO_LPASS_SB_NGD2_TX_MSG5_ADDR A:0x677c2044
y.create.l HWIO_LPASS_SB_NGD2_TX_MSG6_ADDR A:0x677c2048
y.create.l HWIO_LPASS_SB_NGD2_TX_MSG7_ADDR A:0x677c204c
y.create.l HWIO_LPASS_SB_NGD2_TX_MSG8_ADDR A:0x677c2050
y.create.l HWIO_LPASS_SB_NGD2_TX_MSG9_ADDR A:0x677c2054
y.create.l HWIO_LPASS_SB_NGD2_RX_MSG0_ADDR A:0x677c2070
y.create.l HWIO_LPASS_SB_NGD2_RX_MSG1_ADDR A:0x677c2074
y.create.l HWIO_LPASS_SB_NGD2_RX_MSG2_ADDR A:0x677c2078
y.create.l HWIO_LPASS_SB_NGD2_RX_MSG3_ADDR A:0x677c207c
y.create.l HWIO_LPASS_SB_NGD2_RX_MSG4_ADDR A:0x677c2080
y.create.l HWIO_LPASS_SB_NGD2_RX_MSG5_ADDR A:0x677c2084
y.create.l HWIO_LPASS_SB_NGD2_RX_MSG6_ADDR A:0x677c2088
y.create.l HWIO_LPASS_SB_NGD2_RX_MSG7_ADDR A:0x677c208c
y.create.l HWIO_LPASS_SB_NGD2_RX_MSG8_ADDR A:0x677c2090
y.create.l HWIO_LPASS_SB_NGD2_RX_MSG9_ADDR A:0x677c2094
y.create.l HWIO_LPASS_SB_NGD2_IE_STATUS_ADDR A:0x677c20f0
y.create.l HWIO_LPASS_SB_NGD2_VE_STATUS_ADDR A:0x677c2100
y.create.l HWIO_LPASS_SB_PGD_CFG_ADDR A:0x677c0800
y.create.l HWIO_LPASS_SB_PGD_STATUS_ADDR A:0x677c0804
y.create.l HWIO_LPASS_SB_PGD_DEV_INT_EN_ADDR A:0x677c0810
y.create.l HWIO_LPASS_SB_PGD_DEV_INT_STATUS_ADDR A:0x677c0814
y.create.l HWIO_LPASS_SB_PGD_DEV_INT_CLR_ADDR A:0x677c0818
y.create.l HWIO_LPASS_SB_COMP_TRUST_CFG_ADDR A:0x677c3000
y.create.l HWIO_LPASS_SB_COMP_TRUST_DEV1_ADDR A:0x677c3004
y.create.l HWIO_LPASS_SB_COMP_TRUST_DEV2_ADDR A:0x677c3008
y.create.l HWIO_LPASS_SB_PGD_TRUST_OWN_EE0_ADDR A:0x677c300c
y.create.l HWIO_LPASS_SB_PGD_TRUST_OWN_EE1_ADDR A:0x677c3010
y.create.l HWIO_LPASS_SB_PGD_TRUST_OWN_EE2_ADDR A:0x677c3014
y.create.l HWIO_LPASS_SB_COMP_TEST_ADDR A:0x677c4000
y.create.l HWIO_LPASS_SB_COMP_DEBUG_ADDR A:0x677c4004
y.create.l HWIO_LPASS_SB_PGD_PORT_INT_EN_EE0_ADDR A:0x677c5000
y.create.l HWIO_LPASS_SB_PGD_PORT_INT_EN_EE1_ADDR A:0x677c6000
y.create.l HWIO_LPASS_SB_PGD_PORT_INT_EN_EE2_ADDR A:0x677c7000
y.create.l HWIO_LPASS_SB_PGD_PORT_INT_STATUS_EE0_ADDR A:0x677c5004
y.create.l HWIO_LPASS_SB_PGD_PORT_INT_STATUS_EE1_ADDR A:0x677c6004
y.create.l HWIO_LPASS_SB_PGD_PORT_INT_STATUS_EE2_ADDR A:0x677c7004
y.create.l HWIO_LPASS_SB_PGD_PORT_INT_CLR_EE0_ADDR A:0x677c5008
y.create.l HWIO_LPASS_SB_PGD_PORT_INT_CLR_EE1_ADDR A:0x677c6008
y.create.l HWIO_LPASS_SB_PGD_PORT_INT_CLR_EE2_ADDR A:0x677c7008
y.create.l HWIO_LPASS_SB_PGD_PORT_CFG0_ADDR A:0x677d4000
y.create.l HWIO_LPASS_SB_PGD_PORT_CFG1_ADDR A:0x677d5000
y.create.l HWIO_LPASS_SB_PGD_PORT_CFG2_ADDR A:0x677d6000
y.create.l HWIO_LPASS_SB_PGD_PORT_CFG3_ADDR A:0x677d7000
y.create.l HWIO_LPASS_SB_PGD_PORT_CFG4_ADDR A:0x677d8000
y.create.l HWIO_LPASS_SB_PGD_PORT_CFG5_ADDR A:0x677d9000
y.create.l HWIO_LPASS_SB_PGD_PORT_CFG6_ADDR A:0x677da000
y.create.l HWIO_LPASS_SB_PGD_PORT_CFG7_ADDR A:0x677db000
y.create.l HWIO_LPASS_SB_PGD_PORT_CFG8_ADDR A:0x677dc000
y.create.l HWIO_LPASS_SB_PGD_PORT_CFG9_ADDR A:0x677dd000
y.create.l HWIO_LPASS_SB_PGD_PORT_STATUS0_ADDR A:0x677d4004
y.create.l HWIO_LPASS_SB_PGD_PORT_STATUS1_ADDR A:0x677d5004
y.create.l HWIO_LPASS_SB_PGD_PORT_STATUS2_ADDR A:0x677d6004
y.create.l HWIO_LPASS_SB_PGD_PORT_STATUS3_ADDR A:0x677d7004
y.create.l HWIO_LPASS_SB_PGD_PORT_STATUS4_ADDR A:0x677d8004
y.create.l HWIO_LPASS_SB_PGD_PORT_STATUS5_ADDR A:0x677d9004
y.create.l HWIO_LPASS_SB_PGD_PORT_STATUS6_ADDR A:0x677da004
y.create.l HWIO_LPASS_SB_PGD_PORT_STATUS7_ADDR A:0x677db004
y.create.l HWIO_LPASS_SB_PGD_PORT_STATUS8_ADDR A:0x677dc004
y.create.l HWIO_LPASS_SB_PGD_PORT_STATUS9_ADDR A:0x677dd004
y.create.l HWIO_LPASS_SB_PGD_PORT_PARAM0_ADDR A:0x677d4008
y.create.l HWIO_LPASS_SB_PGD_PORT_PARAM1_ADDR A:0x677d5008
y.create.l HWIO_LPASS_SB_PGD_PORT_PARAM2_ADDR A:0x677d6008
y.create.l HWIO_LPASS_SB_PGD_PORT_PARAM3_ADDR A:0x677d7008
y.create.l HWIO_LPASS_SB_PGD_PORT_PARAM4_ADDR A:0x677d8008
y.create.l HWIO_LPASS_SB_PGD_PORT_PARAM5_ADDR A:0x677d9008
y.create.l HWIO_LPASS_SB_PGD_PORT_PARAM6_ADDR A:0x677da008
y.create.l HWIO_LPASS_SB_PGD_PORT_PARAM7_ADDR A:0x677db008
y.create.l HWIO_LPASS_SB_PGD_PORT_PARAM8_ADDR A:0x677dc008
y.create.l HWIO_LPASS_SB_PGD_PORT_PARAM9_ADDR A:0x677dd008
y.create.l HWIO_LPASS_SB_PGD_PORT_BLK_SIZE0_ADDR A:0x677d400c
y.create.l HWIO_LPASS_SB_PGD_PORT_BLK_SIZE1_ADDR A:0x677d500c
y.create.l HWIO_LPASS_SB_PGD_PORT_BLK_SIZE2_ADDR A:0x677d600c
y.create.l HWIO_LPASS_SB_PGD_PORT_BLK_SIZE3_ADDR A:0x677d700c
y.create.l HWIO_LPASS_SB_PGD_PORT_BLK_SIZE4_ADDR A:0x677d800c
y.create.l HWIO_LPASS_SB_PGD_PORT_BLK_SIZE5_ADDR A:0x677d900c
y.create.l HWIO_LPASS_SB_PGD_PORT_BLK_SIZE6_ADDR A:0x677da00c
y.create.l HWIO_LPASS_SB_PGD_PORT_BLK_SIZE7_ADDR A:0x677db00c
y.create.l HWIO_LPASS_SB_PGD_PORT_BLK_SIZE8_ADDR A:0x677dc00c
y.create.l HWIO_LPASS_SB_PGD_PORT_BLK_SIZE9_ADDR A:0x677dd00c
y.create.l HWIO_LPASS_SB_PGD_PORT_TRANS_SIZE0_ADDR A:0x677d4010
y.create.l HWIO_LPASS_SB_PGD_PORT_TRANS_SIZE1_ADDR A:0x677d5010
y.create.l HWIO_LPASS_SB_PGD_PORT_TRANS_SIZE2_ADDR A:0x677d6010
y.create.l HWIO_LPASS_SB_PGD_PORT_TRANS_SIZE3_ADDR A:0x677d7010
y.create.l HWIO_LPASS_SB_PGD_PORT_TRANS_SIZE4_ADDR A:0x677d8010
y.create.l HWIO_LPASS_SB_PGD_PORT_TRANS_SIZE5_ADDR A:0x677d9010
y.create.l HWIO_LPASS_SB_PGD_PORT_TRANS_SIZE6_ADDR A:0x677da010
y.create.l HWIO_LPASS_SB_PGD_PORT_TRANS_SIZE7_ADDR A:0x677db010
y.create.l HWIO_LPASS_SB_PGD_PORT_TRANS_SIZE8_ADDR A:0x677dc010
y.create.l HWIO_LPASS_SB_PGD_PORT_TRANS_SIZE9_ADDR A:0x677dd010
y.create.l HWIO_LPASS_SB_PGD_PORT_MULTI_CHNL0_ADDR A:0x677d4014
y.create.l HWIO_LPASS_SB_PGD_PORT_MULTI_CHNL1_ADDR A:0x677d5014
y.create.l HWIO_LPASS_SB_PGD_PORT_MULTI_CHNL2_ADDR A:0x677d6014
y.create.l HWIO_LPASS_SB_PGD_PORT_MULTI_CHNL3_ADDR A:0x677d7014
y.create.l HWIO_LPASS_SB_PGD_PORT_MULTI_CHNL4_ADDR A:0x677d8014
y.create.l HWIO_LPASS_SB_PGD_PORT_MULTI_CHNL5_ADDR A:0x677d9014
y.create.l HWIO_LPASS_SB_PGD_PORT_MULTI_CHNL6_ADDR A:0x677da014
y.create.l HWIO_LPASS_SB_PGD_PORT_MULTI_CHNL7_ADDR A:0x677db014
y.create.l HWIO_LPASS_SB_PGD_PORT_MULTI_CHNL8_ADDR A:0x677dc014
y.create.l HWIO_LPASS_SB_PGD_PORT_MULTI_CHNL9_ADDR A:0x677dd014
y.create.l HWIO_LPASS_SB_PGD_PORT_PUSHPULL0_ADDR A:0x677d4018
y.create.l HWIO_LPASS_SB_PGD_PORT_PUSHPULL1_ADDR A:0x677d5018
y.create.l HWIO_LPASS_SB_PGD_PORT_PUSHPULL2_ADDR A:0x677d6018
y.create.l HWIO_LPASS_SB_PGD_PORT_PUSHPULL3_ADDR A:0x677d7018
y.create.l HWIO_LPASS_SB_PGD_PORT_PUSHPULL4_ADDR A:0x677d8018
y.create.l HWIO_LPASS_SB_PGD_PORT_PUSHPULL5_ADDR A:0x677d9018
y.create.l HWIO_LPASS_SB_PGD_PORT_PUSHPULL6_ADDR A:0x677da018
y.create.l HWIO_LPASS_SB_PGD_PORT_PUSHPULL7_ADDR A:0x677db018
y.create.l HWIO_LPASS_SB_PGD_PORT_PUSHPULL8_ADDR A:0x677dc018
y.create.l HWIO_LPASS_SB_PGD_PORT_PUSHPULL9_ADDR A:0x677dd018
y.create.l HWIO_LPASS_SB_PGD_IE_STATUS_ADDR A:0x677c0820
y.create.l HWIO_LPASS_SB_PGD_VE_STATUS_ADDR A:0x677c0830
y.create.l HWIO_LPASS_SB_PGD_PC_CFG0_ADDR A:0x677c8000
y.create.l HWIO_LPASS_SB_PGD_PC_CFG1_ADDR A:0x677c8800
y.create.l HWIO_LPASS_SB_PGD_PC_CFG2_ADDR A:0x677c9000
y.create.l HWIO_LPASS_SB_PGD_PC_CFG3_ADDR A:0x677c9800
y.create.l HWIO_LPASS_SB_PGD_PC_CFG4_ADDR A:0x677ca000
y.create.l HWIO_LPASS_SB_PGD_PC_CFG5_ADDR A:0x677ca800
y.create.l HWIO_LPASS_SB_PGD_PC_CFG6_ADDR A:0x677cb000
y.create.l HWIO_LPASS_SB_PGD_PC_CFG7_ADDR A:0x677cb800
y.create.l HWIO_LPASS_SB_PGD_PC_CFG8_ADDR A:0x677cc000
y.create.l HWIO_LPASS_SB_PGD_PC_CFG9_ADDR A:0x677cc800
y.create.l HWIO_LPASS_SB_PGD_PC_VAL0_ADDR A:0x677c8004
y.create.l HWIO_LPASS_SB_PGD_PC_VAL1_ADDR A:0x677c8804
y.create.l HWIO_LPASS_SB_PGD_PC_VAL2_ADDR A:0x677c9004
y.create.l HWIO_LPASS_SB_PGD_PC_VAL3_ADDR A:0x677c9804
y.create.l HWIO_LPASS_SB_PGD_PC_VAL4_ADDR A:0x677ca004
y.create.l HWIO_LPASS_SB_PGD_PC_VAL5_ADDR A:0x677ca804
y.create.l HWIO_LPASS_SB_PGD_PC_VAL6_ADDR A:0x677cb004
y.create.l HWIO_LPASS_SB_PGD_PC_VAL7_ADDR A:0x677cb804
y.create.l HWIO_LPASS_SB_PGD_PC_VAL8_ADDR A:0x677cc004
y.create.l HWIO_LPASS_SB_PGD_PC_VAL9_ADDR A:0x677cc804
y.create.l HWIO_LPASS_SB_PGD_PC_VFR_TS0_ADDR A:0x677c8008
y.create.l HWIO_LPASS_SB_PGD_PC_VFR_TS1_ADDR A:0x677c8808
y.create.l HWIO_LPASS_SB_PGD_PC_VFR_TS2_ADDR A:0x677c9008
y.create.l HWIO_LPASS_SB_PGD_PC_VFR_TS3_ADDR A:0x677c9808
y.create.l HWIO_LPASS_SB_PGD_PC_VFR_TS4_ADDR A:0x677ca008
y.create.l HWIO_LPASS_SB_PGD_PC_VFR_TS5_ADDR A:0x677ca808
y.create.l HWIO_LPASS_SB_PGD_PC_VFR_TS6_ADDR A:0x677cb008
y.create.l HWIO_LPASS_SB_PGD_PC_VFR_TS7_ADDR A:0x677cb808
y.create.l HWIO_LPASS_SB_PGD_PC_VFR_TS8_ADDR A:0x677cc008
y.create.l HWIO_LPASS_SB_PGD_PC_VFR_TS9_ADDR A:0x677cc808
y.create.l HWIO_LPASS_SB_PGD_PC_VFR_TS_STATUS0_ADDR A:0x677c800c
y.create.l HWIO_LPASS_SB_PGD_PC_VFR_TS_STATUS1_ADDR A:0x677c880c
y.create.l HWIO_LPASS_SB_PGD_PC_VFR_TS_STATUS2_ADDR A:0x677c900c
y.create.l HWIO_LPASS_SB_PGD_PC_VFR_TS_STATUS3_ADDR A:0x677c980c
y.create.l HWIO_LPASS_SB_PGD_PC_VFR_TS_STATUS4_ADDR A:0x677ca00c
y.create.l HWIO_LPASS_SB_PGD_PC_VFR_TS_STATUS5_ADDR A:0x677ca80c
y.create.l HWIO_LPASS_SB_PGD_PC_VFR_TS_STATUS6_ADDR A:0x677cb00c
y.create.l HWIO_LPASS_SB_PGD_PC_VFR_TS_STATUS7_ADDR A:0x677cb80c
y.create.l HWIO_LPASS_SB_PGD_PC_VFR_TS_STATUS8_ADDR A:0x677cc00c
y.create.l HWIO_LPASS_SB_PGD_PC_VFR_TS_STATUS9_ADDR A:0x677cc80c
y.create.l HWIO_LPASS_SB_PGD_PC_VFR_TS_CLR0_ADDR A:0x677c8010
y.create.l HWIO_LPASS_SB_PGD_PC_VFR_TS_CLR1_ADDR A:0x677c8810
y.create.l HWIO_LPASS_SB_PGD_PC_VFR_TS_CLR2_ADDR A:0x677c9010
y.create.l HWIO_LPASS_SB_PGD_PC_VFR_TS_CLR3_ADDR A:0x677c9810
y.create.l HWIO_LPASS_SB_PGD_PC_VFR_TS_CLR4_ADDR A:0x677ca010
y.create.l HWIO_LPASS_SB_PGD_PC_VFR_TS_CLR5_ADDR A:0x677ca810
y.create.l HWIO_LPASS_SB_PGD_PC_VFR_TS_CLR6_ADDR A:0x677cb010
y.create.l HWIO_LPASS_SB_PGD_PC_VFR_TS_CLR7_ADDR A:0x677cb810
y.create.l HWIO_LPASS_SB_PGD_PC_VFR_TS_CLR8_ADDR A:0x677cc010
y.create.l HWIO_LPASS_SB_PGD_PC_VFR_TS_CLR9_ADDR A:0x677cc810
y.create.l HWIO_LPASS_SB_PGD_PC_VAL_SHADOW0_ADDR A:0x677c8014
y.create.l HWIO_LPASS_SB_PGD_PC_VAL_SHADOW1_ADDR A:0x677c8814
y.create.l HWIO_LPASS_SB_PGD_PC_VAL_SHADOW2_ADDR A:0x677c9014
y.create.l HWIO_LPASS_SB_PGD_PC_VAL_SHADOW3_ADDR A:0x677c9814
y.create.l HWIO_LPASS_SB_PGD_PC_VAL_SHADOW4_ADDR A:0x677ca014
y.create.l HWIO_LPASS_SB_PGD_PC_VAL_SHADOW5_ADDR A:0x677ca814
y.create.l HWIO_LPASS_SB_PGD_PC_VAL_SHADOW6_ADDR A:0x677cb014
y.create.l HWIO_LPASS_SB_PGD_PC_VAL_SHADOW7_ADDR A:0x677cb814
y.create.l HWIO_LPASS_SB_PGD_PC_VAL_SHADOW8_ADDR A:0x677cc014
y.create.l HWIO_LPASS_SB_PGD_PC_VAL_SHADOW9_ADDR A:0x677cc814
y.create.l HWIO_LPASS_SB_PGD_PC_TIMESTAMP_LSB0_ADDR A:0x677c8018
y.create.l HWIO_LPASS_SB_PGD_PC_TIMESTAMP_LSB1_ADDR A:0x677c8818
y.create.l HWIO_LPASS_SB_PGD_PC_TIMESTAMP_LSB2_ADDR A:0x677c9018
y.create.l HWIO_LPASS_SB_PGD_PC_TIMESTAMP_LSB3_ADDR A:0x677c9818
y.create.l HWIO_LPASS_SB_PGD_PC_TIMESTAMP_LSB4_ADDR A:0x677ca018
y.create.l HWIO_LPASS_SB_PGD_PC_TIMESTAMP_LSB5_ADDR A:0x677ca818
y.create.l HWIO_LPASS_SB_PGD_PC_TIMESTAMP_LSB6_ADDR A:0x677cb018
y.create.l HWIO_LPASS_SB_PGD_PC_TIMESTAMP_LSB7_ADDR A:0x677cb818
y.create.l HWIO_LPASS_SB_PGD_PC_TIMESTAMP_LSB8_ADDR A:0x677cc018
y.create.l HWIO_LPASS_SB_PGD_PC_TIMESTAMP_LSB9_ADDR A:0x677cc818
y.create.l HWIO_LPASS_SB_PGD_PC_TIMESTAMP_MSB0_ADDR A:0x677c801c
y.create.l HWIO_LPASS_SB_PGD_PC_TIMESTAMP_MSB1_ADDR A:0x677c881c
y.create.l HWIO_LPASS_SB_PGD_PC_TIMESTAMP_MSB2_ADDR A:0x677c901c
y.create.l HWIO_LPASS_SB_PGD_PC_TIMESTAMP_MSB3_ADDR A:0x677c981c
y.create.l HWIO_LPASS_SB_PGD_PC_TIMESTAMP_MSB4_ADDR A:0x677ca01c
y.create.l HWIO_LPASS_SB_PGD_PC_TIMESTAMP_MSB5_ADDR A:0x677ca81c
y.create.l HWIO_LPASS_SB_PGD_PC_TIMESTAMP_MSB6_ADDR A:0x677cb01c
y.create.l HWIO_LPASS_SB_PGD_PC_TIMESTAMP_MSB7_ADDR A:0x677cb81c
y.create.l HWIO_LPASS_SB_PGD_PC_TIMESTAMP_MSB8_ADDR A:0x677cc01c
y.create.l HWIO_LPASS_SB_PGD_PC_TIMESTAMP_MSB9_ADDR A:0x677cc81c
y.create.l HWIO_USB30_GUSB2PHYCFG_REGS_0_GUSB2PHYCFG_ADDR A:0x68a0c200
y.create.l HWIO_USB30_GUSB2I2CCTL_REGS_0_GUSB2I2CCTL_ADDR A:0x68a0c240
y.create.l HWIO_USB30_GUSB2PHYACC_REGS_0_GUSB2PHYACC_ULPI_ADDR A:0x68a0c280
y.create.l HWIO_USB30_GUSB3PIPECTL_REGS_0_GUSB3PIPECTL_ADDR A:0x68a0c2c0
y.create.l HWIO_USB30_GTXFIFOSIZ_REGS_0_GTXFIFOSIZ0_ADDR A:0x68a0c300
y.create.l HWIO_USB30_GTXFIFOSIZ_REGS_0_GTXFIFOSIZ1_ADDR A:0x68a0c304
y.create.l HWIO_USB30_GTXFIFOSIZ_REGS_0_GTXFIFOSIZ2_ADDR A:0x68a0c308
y.create.l HWIO_USB30_GTXFIFOSIZ_REGS_0_GTXFIFOSIZ3_ADDR A:0x68a0c30c
y.create.l HWIO_USB30_GTXFIFOSIZ_REGS_0_GTXFIFOSIZ4_ADDR A:0x68a0c310
y.create.l HWIO_USB30_GTXFIFOSIZ_REGS_0_GTXFIFOSIZ5_ADDR A:0x68a0c314
y.create.l HWIO_USB30_GTXFIFOSIZ_REGS_0_GTXFIFOSIZ6_ADDR A:0x68a0c318
y.create.l HWIO_USB30_GTXFIFOSIZ_REGS_0_GTXFIFOSIZ7_ADDR A:0x68a0c31c
y.create.l HWIO_USB30_GTXFIFOSIZ_REGS_0_GTXFIFOSIZ8_ADDR A:0x68a0c320
y.create.l HWIO_USB30_GTXFIFOSIZ_REGS_0_GTXFIFOSIZ9_ADDR A:0x68a0c324
y.create.l HWIO_USB30_GTXFIFOSIZ_REGS_0_GTXFIFOSIZ10_ADDR A:0x68a0c328
y.create.l HWIO_USB30_GTXFIFOSIZ_REGS_0_GTXFIFOSIZ11_ADDR A:0x68a0c32c
y.create.l HWIO_USB30_GTXFIFOSIZ_REGS_0_GTXFIFOSIZ12_ADDR A:0x68a0c330
y.create.l HWIO_USB30_GTXFIFOSIZ_REGS_0_GTXFIFOSIZ13_ADDR A:0x68a0c334
y.create.l HWIO_USB30_GTXFIFOSIZ_REGS_0_GTXFIFOSIZ14_ADDR A:0x68a0c338
y.create.l HWIO_USB30_GTXFIFOSIZ_REGS_0_GTXFIFOSIZ15_ADDR A:0x68a0c33c
y.create.l HWIO_USB30_GRXFIFOSIZ_REGS_0_GRXFIFOSIZ0_ADDR A:0x68a0c380
y.create.l HWIO_USB30_GRXFIFOSIZ_REGS_0_GRXFIFOSIZ1_ADDR A:0x68a0c384
y.create.l HWIO_USB30_GRXFIFOSIZ_REGS_0_GRXFIFOSIZ2_ADDR A:0x68a0c388
y.create.l HWIO_USB30_GEVNTADRLO_REGS_0_GEVNTADRLO_ADDR A:0x68a0c400
y.create.l HWIO_USB30_GEVNTADRLO_REGS_1_GEVNTADRLO_ADDR A:0x68a0c410
y.create.l HWIO_USB30_GEVNTADRLO_REGS_0_GEVNTADRHI_ADDR A:0x68a0c404
y.create.l HWIO_USB30_GEVNTADRLO_REGS_1_GEVNTADRHI_ADDR A:0x68a0c414
y.create.l HWIO_USB30_GEVNTADRLO_REGS_0_GEVNTSIZ_ADDR A:0x68a0c408
y.create.l HWIO_USB30_GEVNTADRLO_REGS_1_GEVNTSIZ_ADDR A:0x68a0c418
y.create.l HWIO_USB30_GEVNTADRLO_REGS_0_GEVNTCOUNT_ADDR A:0x68a0c40c
y.create.l HWIO_USB30_GEVNTADRLO_REGS_1_GEVNTCOUNT_ADDR A:0x68a0c41c
y.create.l HWIO_USB30_GSBUSCFG0_ADDR A:0x68a0c100
y.create.l HWIO_USB30_GSBUSCFG1_ADDR A:0x68a0c104
y.create.l HWIO_USB30_GTXTHRCFG_ADDR A:0x68a0c108
y.create.l HWIO_USB30_GRXTHRCFG_ADDR A:0x68a0c10c
y.create.l HWIO_USB30_GCTL_ADDR A:0x68a0c110
y.create.l HWIO_USB30_GPMSTS_ADDR A:0x68a0c114
y.create.l HWIO_USB30_GSTS_ADDR A:0x68a0c118
y.create.l HWIO_USB30_GUCTL1_ADDR A:0x68a0c11c
y.create.l HWIO_USB30_GSNPSID_ADDR A:0x68a0c120
y.create.l HWIO_USB30_GGPIO_ADDR A:0x68a0c124
y.create.l HWIO_USB30_GUID_ADDR A:0x68a0c128
y.create.l HWIO_USB30_GUCTL_ADDR A:0x68a0c12c
y.create.l HWIO_USB30_GBUSERRADDRLO_ADDR A:0x68a0c130
y.create.l HWIO_USB30_GBUSERRADDRHI_ADDR A:0x68a0c134
y.create.l HWIO_USB30_GPRTBIMAPLO_ADDR A:0x68a0c138
y.create.l HWIO_USB30_GPRTBIMAPHI_ADDR A:0x68a0c13c
y.create.l HWIO_USB30_GHWPARAMS0_ADDR A:0x68a0c140
y.create.l HWIO_USB30_GHWPARAMS1_ADDR A:0x68a0c144
y.create.l HWIO_USB30_GHWPARAMS2_ADDR A:0x68a0c148
y.create.l HWIO_USB30_GHWPARAMS3_ADDR A:0x68a0c14c
y.create.l HWIO_USB30_GHWPARAMS4_ADDR A:0x68a0c150
y.create.l HWIO_USB30_GHWPARAMS5_ADDR A:0x68a0c154
y.create.l HWIO_USB30_GHWPARAMS6_ADDR A:0x68a0c158
y.create.l HWIO_USB30_GHWPARAMS7_ADDR A:0x68a0c15c
y.create.l HWIO_USB30_GDBGFIFOSPACE_ADDR A:0x68a0c160
y.create.l HWIO_USB30_GDBGLTSSM_ADDR A:0x68a0c164
y.create.l HWIO_USB30_GDBGLNMCC_ADDR A:0x68a0c168
y.create.l HWIO_USB30_GDBGBMU_ADDR A:0x68a0c16c
y.create.l HWIO_USB30_GDBGLSPMUX_HST_ADDR A:0x68a0c170
y.create.l HWIO_USB30_GDBGLSP_ADDR A:0x68a0c174
y.create.l HWIO_USB30_GDBGEPINFO0_ADDR A:0x68a0c178
y.create.l HWIO_USB30_GDBGEPINFO1_ADDR A:0x68a0c17c
y.create.l HWIO_USB30_GPRTBIMAP_HSLO_ADDR A:0x68a0c180
y.create.l HWIO_USB30_GPRTBIMAP_HSHI_ADDR A:0x68a0c184
y.create.l HWIO_USB30_GPRTBIMAP_FSLO_ADDR A:0x68a0c188
y.create.l HWIO_USB30_GPRTBIMAP_FSHI_ADDR A:0x68a0c18c
y.create.l HWIO_USB30_GHWPARAMS8_ADDR A:0x68a0c600
y.create.l HWIO_USB30_GTXFIFOPRIDEV_ADDR A:0x68a0c610
y.create.l HWIO_USB30_GTXFIFOPRIHST_ADDR A:0x68a0c618
y.create.l HWIO_USB30_GRXFIFOPRIHST_ADDR A:0x68a0c61c
y.create.l HWIO_USB30_GDMAHLRATIO_ADDR A:0x68a0c624
y.create.l HWIO_USB30_GFLADJ_ADDR A:0x68a0c630
y.create.l HWIO_USB30_RSVD_REGS_0_RSVD_ADDR A:0x68a0c780
y.create.l HWIO_USB30_RSVD_REGS_1_RSVD_ADDR A:0x68a0c784
y.create.l HWIO_USB30_RSVD_REGS_2_RSVD_ADDR A:0x68a0c788
y.create.l HWIO_USB30_RSVD_REGS_3_RSVD_ADDR A:0x68a0c78c
y.create.l HWIO_USB30_RSVD_REGS_4_RSVD_ADDR A:0x68a0c790
y.create.l HWIO_USB30_RSVD_REGS_5_RSVD_ADDR A:0x68a0c794
y.create.l HWIO_USB30_RSVD_REGS_6_RSVD_ADDR A:0x68a0c798
y.create.l HWIO_USB30_RSVD_REGS_7_RSVD_ADDR A:0x68a0c79c
y.create.l HWIO_USB30_RSVD_REGS_8_RSVD_ADDR A:0x68a0c7a0
y.create.l HWIO_USB30_RSVD_REGS_9_RSVD_ADDR A:0x68a0c7a4
y.create.l HWIO_USB30_DEPCMDPAR2_REGS_0_DEPCMDPAR2_ADDR A:0x68a0c800
y.create.l HWIO_USB30_DEPCMDPAR2_REGS_1_DEPCMDPAR2_ADDR A:0x68a0c810
y.create.l HWIO_USB30_DEPCMDPAR2_REGS_2_DEPCMDPAR2_ADDR A:0x68a0c820
y.create.l HWIO_USB30_DEPCMDPAR2_REGS_3_DEPCMDPAR2_ADDR A:0x68a0c830
y.create.l HWIO_USB30_DEPCMDPAR2_REGS_4_DEPCMDPAR2_ADDR A:0x68a0c840
y.create.l HWIO_USB30_DEPCMDPAR2_REGS_5_DEPCMDPAR2_ADDR A:0x68a0c850
y.create.l HWIO_USB30_DEPCMDPAR2_REGS_6_DEPCMDPAR2_ADDR A:0x68a0c860
y.create.l HWIO_USB30_DEPCMDPAR2_REGS_7_DEPCMDPAR2_ADDR A:0x68a0c870
y.create.l HWIO_USB30_DEPCMDPAR2_REGS_8_DEPCMDPAR2_ADDR A:0x68a0c880
y.create.l HWIO_USB30_DEPCMDPAR2_REGS_9_DEPCMDPAR2_ADDR A:0x68a0c890
y.create.l HWIO_USB30_DEPCMDPAR2_REGS_0_DEPCMDPAR1_ADDR A:0x68a0c804
y.create.l HWIO_USB30_DEPCMDPAR2_REGS_1_DEPCMDPAR1_ADDR A:0x68a0c814
y.create.l HWIO_USB30_DEPCMDPAR2_REGS_2_DEPCMDPAR1_ADDR A:0x68a0c824
y.create.l HWIO_USB30_DEPCMDPAR2_REGS_3_DEPCMDPAR1_ADDR A:0x68a0c834
y.create.l HWIO_USB30_DEPCMDPAR2_REGS_4_DEPCMDPAR1_ADDR A:0x68a0c844
y.create.l HWIO_USB30_DEPCMDPAR2_REGS_5_DEPCMDPAR1_ADDR A:0x68a0c854
y.create.l HWIO_USB30_DEPCMDPAR2_REGS_6_DEPCMDPAR1_ADDR A:0x68a0c864
y.create.l HWIO_USB30_DEPCMDPAR2_REGS_7_DEPCMDPAR1_ADDR A:0x68a0c874
y.create.l HWIO_USB30_DEPCMDPAR2_REGS_8_DEPCMDPAR1_ADDR A:0x68a0c884
y.create.l HWIO_USB30_DEPCMDPAR2_REGS_9_DEPCMDPAR1_ADDR A:0x68a0c894
y.create.l HWIO_USB30_DEPCMDPAR2_REGS_0_DEPCMDPAR0_ADDR A:0x68a0c808
y.create.l HWIO_USB30_DEPCMDPAR2_REGS_1_DEPCMDPAR0_ADDR A:0x68a0c818
y.create.l HWIO_USB30_DEPCMDPAR2_REGS_2_DEPCMDPAR0_ADDR A:0x68a0c828
y.create.l HWIO_USB30_DEPCMDPAR2_REGS_3_DEPCMDPAR0_ADDR A:0x68a0c838
y.create.l HWIO_USB30_DEPCMDPAR2_REGS_4_DEPCMDPAR0_ADDR A:0x68a0c848
y.create.l HWIO_USB30_DEPCMDPAR2_REGS_5_DEPCMDPAR0_ADDR A:0x68a0c858
y.create.l HWIO_USB30_DEPCMDPAR2_REGS_6_DEPCMDPAR0_ADDR A:0x68a0c868
y.create.l HWIO_USB30_DEPCMDPAR2_REGS_7_DEPCMDPAR0_ADDR A:0x68a0c878
y.create.l HWIO_USB30_DEPCMDPAR2_REGS_8_DEPCMDPAR0_ADDR A:0x68a0c888
y.create.l HWIO_USB30_DEPCMDPAR2_REGS_9_DEPCMDPAR0_ADDR A:0x68a0c898
y.create.l HWIO_USB30_DEPCMDPAR2_REGS_0_DEPCMD_ADDR A:0x68a0c80c
y.create.l HWIO_USB30_DEPCMDPAR2_REGS_1_DEPCMD_ADDR A:0x68a0c81c
y.create.l HWIO_USB30_DEPCMDPAR2_REGS_2_DEPCMD_ADDR A:0x68a0c82c
y.create.l HWIO_USB30_DEPCMDPAR2_REGS_3_DEPCMD_ADDR A:0x68a0c83c
y.create.l HWIO_USB30_DEPCMDPAR2_REGS_4_DEPCMD_ADDR A:0x68a0c84c
y.create.l HWIO_USB30_DEPCMDPAR2_REGS_5_DEPCMD_ADDR A:0x68a0c85c
y.create.l HWIO_USB30_DEPCMDPAR2_REGS_6_DEPCMD_ADDR A:0x68a0c86c
y.create.l HWIO_USB30_DEPCMDPAR2_REGS_7_DEPCMD_ADDR A:0x68a0c87c
y.create.l HWIO_USB30_DEPCMDPAR2_REGS_8_DEPCMD_ADDR A:0x68a0c88c
y.create.l HWIO_USB30_DEPCMDPAR2_REGS_9_DEPCMD_ADDR A:0x68a0c89c
y.create.l HWIO_USB30_DCFG_ADDR A:0x68a0c700
y.create.l HWIO_USB30_DCTL_ADDR A:0x68a0c704
y.create.l HWIO_USB30_DEVTEN_ADDR A:0x68a0c708
y.create.l HWIO_USB30_DSTS_ADDR A:0x68a0c70c
y.create.l HWIO_USB30_DGCMDPAR_ADDR A:0x68a0c710
y.create.l HWIO_USB30_DGCMD_ADDR A:0x68a0c714
y.create.l HWIO_USB30_DALEPENA_ADDR A:0x68a0c720
y.create.l HWIO_USB30_RSVD_HC_REGS_0_RSVD_HC_ADDR A:0x68a0001c
y.create.l HWIO_USB30_CAPLENGTH_ADDR A:0x68a00000
y.create.l HWIO_USB30_HCSPARAMS1_ADDR A:0x68a00004
y.create.l HWIO_USB30_HCSPARAMS2_ADDR A:0x68a00008
y.create.l HWIO_USB30_HCSPARAMS3_ADDR A:0x68a0000c
y.create.l HWIO_USB30_HCCPARAMS_ADDR A:0x68a00010
y.create.l HWIO_USB30_DBOFF_ADDR A:0x68a00014
y.create.l HWIO_USB30_RTSOFF_ADDR A:0x68a00018
y.create.l HWIO_USB30_USBCMD_ADDR A:0x68a00020
y.create.l HWIO_USB30_USBSTS_ADDR A:0x68a00024
y.create.l HWIO_USB30_PAGESIZE_ADDR A:0x68a00028
y.create.l HWIO_USB30_DNCTRL_ADDR A:0x68a00034
y.create.l HWIO_USB30_CRCR_LO_ADDR A:0x68a00038
y.create.l HWIO_USB30_CRCR_HI_ADDR A:0x68a0003c
y.create.l HWIO_USB30_DCBAAP_LO_ADDR A:0x68a00050
y.create.l HWIO_USB30_DCBAAP_HI_ADDR A:0x68a00054
y.create.l HWIO_USB30_CONFIG_ADDR A:0x68a00058
y.create.l HWIO_USB30_PORTSC_REGS_0_PORTSC_ADDR A:0x68a00420
y.create.l HWIO_USB30_PORTSC_REGS_1_PORTSC_ADDR A:0x68a00430
y.create.l HWIO_USB30_PORTSC_REGS_0_PORTPMSC_ADDR A:0x68a00424
y.create.l HWIO_USB30_PORTSC_REGS_1_PORTPMSC_ADDR A:0x68a00434
y.create.l HWIO_USB30_PORTSC_REGS_0_PORTLI_ADDR A:0x68a00428
y.create.l HWIO_USB30_PORTSC_REGS_1_PORTLI_ADDR A:0x68a00438
y.create.l HWIO_USB30_PORTSC_REGS_0_PORTHLPMC_ADDR A:0x68a0042c
y.create.l HWIO_USB30_PORTSC_REGS_1_PORTHLPMC_ADDR A:0x68a0043c
y.create.l HWIO_USB30_MFINDEX_ADDR A:0x68a00440
y.create.l HWIO_USB30_RSVDZ_ADDR A:0x68a00444
y.create.l HWIO_USB30_IMAN_REGS_0_IMAN_ADDR A:0x68a00460
y.create.l HWIO_USB30_IMAN_REGS_1_IMAN_ADDR A:0x68a00480
y.create.l HWIO_USB30_IMAN_REGS_0_IMOD_ADDR A:0x68a00464
y.create.l HWIO_USB30_IMAN_REGS_1_IMOD_ADDR A:0x68a00484
y.create.l HWIO_USB30_IMAN_REGS_0_ERSTSZ_ADDR A:0x68a00468
y.create.l HWIO_USB30_IMAN_REGS_1_ERSTSZ_ADDR A:0x68a00488
y.create.l HWIO_USB30_IMAN_REGS_0_RSVDP_ADDR A:0x68a0046c
y.create.l HWIO_USB30_IMAN_REGS_1_RSVDP_ADDR A:0x68a0048c
y.create.l HWIO_USB30_IMAN_REGS_0_ERSTBA_LO_ADDR A:0x68a00470
y.create.l HWIO_USB30_IMAN_REGS_1_ERSTBA_LO_ADDR A:0x68a00490
y.create.l HWIO_USB30_IMAN_REGS_0_ERSTBA_HI_ADDR A:0x68a00474
y.create.l HWIO_USB30_IMAN_REGS_1_ERSTBA_HI_ADDR A:0x68a00494
y.create.l HWIO_USB30_IMAN_REGS_0_ERDP_LO_ADDR A:0x68a00478
y.create.l HWIO_USB30_IMAN_REGS_1_ERDP_LO_ADDR A:0x68a00498
y.create.l HWIO_USB30_IMAN_REGS_0_ERDP_HI_ADDR A:0x68a0047c
y.create.l HWIO_USB30_IMAN_REGS_1_ERDP_HI_ADDR A:0x68a0049c
y.create.l HWIO_USB30_DB_REGS_0_DB_ADDR A:0x68a004a0
y.create.l HWIO_USB30_DB_REGS_1_DB_ADDR A:0x68a004a4
y.create.l HWIO_USB30_DB_REGS_2_DB_ADDR A:0x68a004a8
y.create.l HWIO_USB30_DB_REGS_3_DB_ADDR A:0x68a004ac
y.create.l HWIO_USB30_DB_REGS_4_DB_ADDR A:0x68a004b0
y.create.l HWIO_USB30_DB_REGS_5_DB_ADDR A:0x68a004b4
y.create.l HWIO_USB30_DB_REGS_6_DB_ADDR A:0x68a004b8
y.create.l HWIO_USB30_DB_REGS_7_DB_ADDR A:0x68a004bc
y.create.l HWIO_USB30_DB_REGS_8_DB_ADDR A:0x68a004c0
y.create.l HWIO_USB30_DB_REGS_9_DB_ADDR A:0x68a004c4
y.create.l HWIO_USB30_USBLEGSUP_ADDR A:0x68a008a0
y.create.l HWIO_USB30_USBLEGCTLSTS_ADDR A:0x68a008a4
y.create.l HWIO_USB30_SUPTPRT2_DW0_ADDR A:0x68a008b0
y.create.l HWIO_USB30_SUPTPRT2_DW1_ADDR A:0x68a008b4
y.create.l HWIO_USB30_SUPTPRT2_DW2_ADDR A:0x68a008b8
y.create.l HWIO_USB30_SUPTPRT2_DW3_ADDR A:0x68a008bc
y.create.l HWIO_USB30_SUPTPRT3_DW0_ADDR A:0x68a008c0
y.create.l HWIO_USB30_SUPTPRT3_DW1_ADDR A:0x68a008c4
y.create.l HWIO_USB30_SUPTPRT3_DW2_ADDR A:0x68a008c8
y.create.l HWIO_USB30_SUPTPRT3_DW3_ADDR A:0x68a008cc
y.create.l HWIO_USB30_QSRAM_REG_0_ADDR A:0x68afc000
y.create.l HWIO_USB30_QSRAM_REG_1_ADDR A:0x68afc004
y.create.l HWIO_USB30_QSRAM_REG_2_ADDR A:0x68afc008
y.create.l HWIO_USB30_QSRAM_REG_3_ADDR A:0x68afc00c
y.create.l HWIO_USB30_QSRAM_REG_4_ADDR A:0x68afc010
y.create.l HWIO_USB30_QSRAM_REG_5_ADDR A:0x68afc014
y.create.l HWIO_USB30_QSRAM_REG_6_ADDR A:0x68afc018
y.create.l HWIO_USB30_QSRAM_REG_7_ADDR A:0x68afc01c
y.create.l HWIO_USB30_QSRAM_REG_8_ADDR A:0x68afc020
y.create.l HWIO_USB30_QSRAM_REG_9_ADDR A:0x68afc024
y.create.l HWIO_USB30_IPCAT_REG_ADDR A:0x68af8800
y.create.l HWIO_USB30_CTRL_REG_ADDR A:0x68af8804
y.create.l HWIO_USB30_GENERAL_CFG_ADDR A:0x68af8808
y.create.l HWIO_USB30_RAM1_REG_ADDR A:0x68af880c
y.create.l HWIO_USB30_HS_PHY_CTRL_ADDR A:0x68af8810
y.create.l HWIO_USB30_CHARGING_DET_OUTPUT_ADDR A:0x68af881c
y.create.l HWIO_USB30_ALT_INTERRUPT_EN_ADDR A:0x68af8820
y.create.l HWIO_USB30_HS_PHY_IRQ_STAT_ADDR A:0x68af8824
y.create.l HWIO_USB30_CGCTL_REG_ADDR A:0x68af8828
y.create.l HWIO_USB30_DBG_BUS_REG_ADDR A:0x68af882c
y.create.l HWIO_USB30_SS_PHY_CTRL_ADDR A:0x68af8830
y.create.l HWIO_USB30_PWR_EVNT_IRQ_STAT_ADDR A:0x68af8858
y.create.l HWIO_USB30_PWR_EVNT_IRQ_MASK_ADDR A:0x68af885c
y.create.l HWIO_USB30_HW_SW_EVT_CTRL_REG_ADDR A:0x68af8860
y.create.l HWIO_USB30_FLADJ_30MHZ_REG_ADDR A:0x68af8868
y.create.l HWIO_USB30_M_AW_USER_REG_ADDR A:0x68af886c
y.create.l HWIO_USB30_M_AR_USER_REG_ADDR A:0x68af8870
y.create.l HWIO_USB30_QSCRTCH_REG_0_ADDR A:0x68af88b4
y.create.l HWIO_USB30_QSCRTCH_REG_1_ADDR A:0x68af88b8
y.create.l HWIO_USB30_QSCRTCH_REG_2_ADDR A:0x68af88bc
y.create.l HWIO_USB30_QSCRTCH_REG_3_ADDR A:0x68af88c0
y.create.l HWIO_USB30_QSCRTCH_REG_4_ADDR A:0x68af88c4
y.create.l HWIO_USB30_SS_QMP_PHY_CTRL_ADDR A:0x68af88f0
y.create.l HWIO_USB30_SNPS_CORE_CFG_ADDR A:0x68af88f4
y.create.l HWIO_USB30_USB30_STS_REG_ADDR A:0x68af88f8
y.create.l HWIO_USB30_DBM_EP_CFG_ADDR0_ADDR A:0x68af8000
y.create.l HWIO_USB30_DBM_EP_CFG_ADDR1_ADDR A:0x68af8004
y.create.l HWIO_USB30_DBM_EP_CFG_ADDR2_ADDR A:0x68af8008
y.create.l HWIO_USB30_DBM_EP_CFG_ADDR3_ADDR A:0x68af800c
y.create.l HWIO_USB30_DBM_EP_CFG_ADDR4_ADDR A:0x68af8010
y.create.l HWIO_USB30_DBM_EP_CFG_ADDR5_ADDR A:0x68af8014
y.create.l HWIO_USB30_DBM_EP_CFG_ADDR6_ADDR A:0x68af8018
y.create.l HWIO_USB30_DBM_EP_CFG_ADDR7_ADDR A:0x68af801c
y.create.l HWIO_USB30_DBM_DATA_SIZE_ADDR0_ADDR A:0x68af8080
y.create.l HWIO_USB30_DBM_DATA_SIZE_ADDR1_ADDR A:0x68af8084
y.create.l HWIO_USB30_DBM_DATA_SIZE_ADDR2_ADDR A:0x68af8088
y.create.l HWIO_USB30_DBM_DATA_SIZE_ADDR3_ADDR A:0x68af808c
y.create.l HWIO_USB30_DBM_DATA_SIZE_ADDR4_ADDR A:0x68af8090
y.create.l HWIO_USB30_DBM_DATA_SIZE_ADDR5_ADDR A:0x68af8094
y.create.l HWIO_USB30_DBM_DATA_SIZE_ADDR6_ADDR A:0x68af8098
y.create.l HWIO_USB30_DBM_DATA_SIZE_ADDR7_ADDR A:0x68af809c
y.create.l HWIO_USB30_DBM_DATA_FIFO_ADDR_LSB0_ADDR A:0x68af8100
y.create.l HWIO_USB30_DBM_DATA_FIFO_ADDR_LSB1_ADDR A:0x68af8108
y.create.l HWIO_USB30_DBM_DATA_FIFO_ADDR_LSB2_ADDR A:0x68af8110
y.create.l HWIO_USB30_DBM_DATA_FIFO_ADDR_LSB3_ADDR A:0x68af8118
y.create.l HWIO_USB30_DBM_DATA_FIFO_ADDR_LSB4_ADDR A:0x68af8120
y.create.l HWIO_USB30_DBM_DATA_FIFO_ADDR_LSB5_ADDR A:0x68af8128
y.create.l HWIO_USB30_DBM_DATA_FIFO_ADDR_LSB6_ADDR A:0x68af8130
y.create.l HWIO_USB30_DBM_DATA_FIFO_ADDR_LSB7_ADDR A:0x68af8138
y.create.l HWIO_USB30_DBM_DATA_FIFO_ADDR_MSB0_ADDR A:0x68af8104
y.create.l HWIO_USB30_DBM_DATA_FIFO_ADDR_MSB1_ADDR A:0x68af810c
y.create.l HWIO_USB30_DBM_DATA_FIFO_ADDR_MSB2_ADDR A:0x68af8114
y.create.l HWIO_USB30_DBM_DATA_FIFO_ADDR_MSB3_ADDR A:0x68af811c
y.create.l HWIO_USB30_DBM_DATA_FIFO_ADDR_MSB4_ADDR A:0x68af8124
y.create.l HWIO_USB30_DBM_DATA_FIFO_ADDR_MSB5_ADDR A:0x68af812c
y.create.l HWIO_USB30_DBM_DATA_FIFO_ADDR_MSB6_ADDR A:0x68af8134
y.create.l HWIO_USB30_DBM_DATA_FIFO_ADDR_MSB7_ADDR A:0x68af813c
y.create.l HWIO_USB30_DBM_DATA_FIFO_ADDR_EN_ADDR A:0x68af8200
y.create.l HWIO_USB30_DBM_DATA_FIFO_SIZE_EN_ADDR A:0x68af8204
y.create.l HWIO_USB30_DBM_DBG_CNFG_ADDR A:0x68af8208
y.create.l HWIO_USB30_DBM_DIS_UPDXFER_ADDR A:0x68af8298
y.create.l HWIO_USB30_DBM_DEPCMD_IOC_ADDR A:0x68af829c
y.create.l HWIO_USB30_DBM_DEPCMD_CMDACT_ADDR A:0x68af8300
y.create.l HWIO_USB30_DBM_DEPCMD_HIPRI_ADDR A:0x68af8304
y.create.l HWIO_USB30_DBM_SOFT_RESET_ADDR A:0x68af820c
y.create.l HWIO_USB30_DBM_GEN_CFG_ADDR A:0x68af8210
y.create.l HWIO_USB30_DBM_STATUS_ADDR A:0x68af8214
y.create.l HWIO_USB30_DBM_STATES_ADDR A:0x68af8218
y.create.l HWIO_USB30_DBM_HW_TRB0_EP0_ADDR A:0x68af8220
y.create.l HWIO_USB30_DBM_HW_TRB0_EP1_ADDR A:0x68af8224
y.create.l HWIO_USB30_DBM_HW_TRB0_EP2_ADDR A:0x68af8228
y.create.l HWIO_USB30_DBM_HW_TRB0_EP3_ADDR A:0x68af822c
y.create.l HWIO_USB30_DBM_HW_TRB1_EP0_ADDR A:0x68af8230
y.create.l HWIO_USB30_DBM_HW_TRB1_EP1_ADDR A:0x68af8234
y.create.l HWIO_USB30_DBM_HW_TRB1_EP2_ADDR A:0x68af8238
y.create.l HWIO_USB30_DBM_HW_TRB1_EP3_ADDR A:0x68af823c
y.create.l HWIO_USB30_DBM_HW_TRB2_EP0_ADDR A:0x68af8240
y.create.l HWIO_USB30_DBM_HW_TRB2_EP1_ADDR A:0x68af8244
y.create.l HWIO_USB30_DBM_HW_TRB2_EP2_ADDR A:0x68af8248
y.create.l HWIO_USB30_DBM_HW_TRB2_EP3_ADDR A:0x68af824c
y.create.l HWIO_USB30_DBM_HW_TRB3_EP0_ADDR A:0x68af8250
y.create.l HWIO_USB30_DBM_HW_TRB3_EP1_ADDR A:0x68af8254
y.create.l HWIO_USB30_DBM_HW_TRB3_EP2_ADDR A:0x68af8258
y.create.l HWIO_USB30_DBM_HW_TRB3_EP3_ADDR A:0x68af825c
y.create.l HWIO_USB30_DBM_GEVNTADR_LSB_ADDR A:0x68af8260
y.create.l HWIO_USB30_DBM_GEVNTADR_MSB_ADDR A:0x68af8264
y.create.l HWIO_USB30_DBM_GEVNTSIZ_ADDR A:0x68af8268
y.create.l HWIO_USB30_DBM_DATA_FIFO_EN_ADDR A:0x68af826c
y.create.l HWIO_USB30_DBM_GEVNTADR_ADDR A:0x68af8270
y.create.l HWIO_USB30_DBM_PIPE_CFG_ADDR A:0x68af8274
y.create.l HWIO_USB30_INACTIVITY_TIMER_ADDR A:0x68af8278
y.create.l HWIO_USB30_DBM_DATA_FIFO_ADDR0_ADDR A:0x68af8280
y.create.l HWIO_USB30_DBM_DATA_FIFO_ADDR1_ADDR A:0x68af8284
y.create.l HWIO_USB30_DBM_DATA_FIFO_ADDR2_ADDR A:0x68af8288
y.create.l HWIO_USB30_DBM_DATA_FIFO_ADDR3_ADDR A:0x68af828c
y.create.l HWIO_USB30_DBM_TRB_TRACE_CNT_ADDR A:0x68af8290
y.create.l HWIO_USB30_EP_FIFO_OVERRUN_ADDR_ADDR A:0x68af8294
y.create.l HWIO_USB30_USB30_BAM_CTRL_ADDR A:0x68b04000
y.create.l HWIO_USB30_USB30_BAM_TIMER_ADDR A:0x68b04040
y.create.l HWIO_USB30_USB30_BAM_TIMER_CTRL_ADDR A:0x68b04044
y.create.l HWIO_USB30_USB30_BAM_DESC_CNT_TRSHLD_ADDR A:0x68b04008
y.create.l HWIO_USB30_USB30_BAM_IRQ_STTS_ADDR A:0x68b04014
y.create.l HWIO_USB30_USB30_BAM_IRQ_CLR_ADDR A:0x68b04018
y.create.l HWIO_USB30_USB30_BAM_IRQ_EN_ADDR A:0x68b0401c
y.create.l HWIO_USB30_USB30_BAM_CNFG_BITS_ADDR A:0x68b0407c
y.create.l HWIO_USB30_USB30_BAM_CNFG_BITS_2_ADDR A:0x68b04084
y.create.l HWIO_USB30_USB30_BAM_REVISION_ADDR A:0x68b05000
y.create.l HWIO_USB30_USB30_BAM_SW_VERSION_ADDR A:0x68b05004
y.create.l HWIO_USB30_USB30_BAM_NUM_PIPES_ADDR A:0x68b05008
y.create.l HWIO_USB30_USB30_BAM_TEST_BUS_SEL_ADDR A:0x68b05010
y.create.l HWIO_USB30_USB30_BAM_TEST_BUS_REG_ADDR A:0x68b05014
y.create.l HWIO_USB30_USB30_BAM_AHB_MASTER_ERR_CTRLS_ADDR A:0x68b05024
y.create.l HWIO_USB30_USB30_BAM_AHB_MASTER_ERR_ADDR_ADDR A:0x68b05028
y.create.l HWIO_USB30_USB30_BAM_AHB_MASTER_ERR_DATA_ADDR A:0x68b0502c
y.create.l HWIO_USB30_USB30_BAM_AHB_MASTER_ERR_ADDR_LSB_ADDR A:0x68b05100
y.create.l HWIO_USB30_USB30_BAM_AHB_MASTER_ERR_ADDR_MSB_ADDR A:0x68b05104
y.create.l HWIO_USB30_USB30_BAM_TRUST_REG_ADDR A:0x68b06000
y.create.l HWIO_USB30_USB30_BAM_P_TRUST_REG0_ADDR A:0x68b06020
y.create.l HWIO_USB30_USB30_BAM_P_TRUST_REG1_ADDR A:0x68b06024
y.create.l HWIO_USB30_USB30_BAM_P_TRUST_REG2_ADDR A:0x68b06028
y.create.l HWIO_USB30_USB30_BAM_P_TRUST_REG3_ADDR A:0x68b0602c
y.create.l HWIO_USB30_USB30_BAM_P_TRUST_REG4_ADDR A:0x68b06030
y.create.l HWIO_USB30_USB30_BAM_P_TRUST_REG5_ADDR A:0x68b06034
y.create.l HWIO_USB30_USB30_BAM_P_TRUST_REG6_ADDR A:0x68b06038
y.create.l HWIO_USB30_USB30_BAM_P_TRUST_REG7_ADDR A:0x68b0603c
y.create.l HWIO_USB30_USB30_BAM_IRQ_SRCS_EE0_ADDR A:0x68b07000
y.create.l HWIO_USB30_USB30_BAM_IRQ_SRCS_EE1_ADDR A:0x68b08000
y.create.l HWIO_USB30_USB30_BAM_IRQ_SRCS_EE2_ADDR A:0x68b09000
y.create.l HWIO_USB30_USB30_BAM_IRQ_SRCS_EE3_ADDR A:0x68b0a000
y.create.l HWIO_USB30_USB30_BAM_IRQ_SRCS_EE4_ADDR A:0x68b0b000
y.create.l HWIO_USB30_USB30_BAM_IRQ_SRCS_EE5_ADDR A:0x68b0c000
y.create.l HWIO_USB30_USB30_BAM_IRQ_SRCS_EE6_ADDR A:0x68b0d000
y.create.l HWIO_USB30_USB30_BAM_IRQ_SRCS_EE7_ADDR A:0x68b0e000
y.create.l HWIO_USB30_USB30_BAM_IRQ_SRCS_MSK_EE0_ADDR A:0x68b07004
y.create.l HWIO_USB30_USB30_BAM_IRQ_SRCS_MSK_EE1_ADDR A:0x68b08004
y.create.l HWIO_USB30_USB30_BAM_IRQ_SRCS_MSK_EE2_ADDR A:0x68b09004
y.create.l HWIO_USB30_USB30_BAM_IRQ_SRCS_MSK_EE3_ADDR A:0x68b0a004
y.create.l HWIO_USB30_USB30_BAM_IRQ_SRCS_MSK_EE4_ADDR A:0x68b0b004
y.create.l HWIO_USB30_USB30_BAM_IRQ_SRCS_MSK_EE5_ADDR A:0x68b0c004
y.create.l HWIO_USB30_USB30_BAM_IRQ_SRCS_MSK_EE6_ADDR A:0x68b0d004
y.create.l HWIO_USB30_USB30_BAM_IRQ_SRCS_MSK_EE7_ADDR A:0x68b0e004
y.create.l HWIO_USB30_USB30_BAM_IRQ_SRCS_UNMASKED_EE0_ADDR A:0x68b07008
y.create.l HWIO_USB30_USB30_BAM_IRQ_SRCS_UNMASKED_EE1_ADDR A:0x68b08008
y.create.l HWIO_USB30_USB30_BAM_IRQ_SRCS_UNMASKED_EE2_ADDR A:0x68b09008
y.create.l HWIO_USB30_USB30_BAM_IRQ_SRCS_UNMASKED_EE3_ADDR A:0x68b0a008
y.create.l HWIO_USB30_USB30_BAM_IRQ_SRCS_UNMASKED_EE4_ADDR A:0x68b0b008
y.create.l HWIO_USB30_USB30_BAM_IRQ_SRCS_UNMASKED_EE5_ADDR A:0x68b0c008
y.create.l HWIO_USB30_USB30_BAM_IRQ_SRCS_UNMASKED_EE6_ADDR A:0x68b0d008
y.create.l HWIO_USB30_USB30_BAM_IRQ_SRCS_UNMASKED_EE7_ADDR A:0x68b0e008
y.create.l HWIO_USB30_USB30_BAM_PIPE_ATTR_EE0_ADDR A:0x68b0700c
y.create.l HWIO_USB30_USB30_BAM_PIPE_ATTR_EE1_ADDR A:0x68b0800c
y.create.l HWIO_USB30_USB30_BAM_PIPE_ATTR_EE2_ADDR A:0x68b0900c
y.create.l HWIO_USB30_USB30_BAM_PIPE_ATTR_EE3_ADDR A:0x68b0a00c
y.create.l HWIO_USB30_USB30_BAM_PIPE_ATTR_EE4_ADDR A:0x68b0b00c
y.create.l HWIO_USB30_USB30_BAM_PIPE_ATTR_EE5_ADDR A:0x68b0c00c
y.create.l HWIO_USB30_USB30_BAM_PIPE_ATTR_EE6_ADDR A:0x68b0d00c
y.create.l HWIO_USB30_USB30_BAM_PIPE_ATTR_EE7_ADDR A:0x68b0e00c
y.create.l HWIO_USB30_USB30_BAM_IRQ_SRCS_ADDR A:0x68b07010
y.create.l HWIO_USB30_USB30_BAM_IRQ_SRCS_MSK_ADDR A:0x68b07014
y.create.l HWIO_USB30_USB30_BAM_IRQ_SRCS_UNMASKED_ADDR A:0x68b07018
y.create.l HWIO_USB30_USB30_BAM_P_CTRL0_ADDR A:0x68b17000
y.create.l HWIO_USB30_USB30_BAM_P_CTRL1_ADDR A:0x68b18000
y.create.l HWIO_USB30_USB30_BAM_P_CTRL2_ADDR A:0x68b19000
y.create.l HWIO_USB30_USB30_BAM_P_CTRL3_ADDR A:0x68b1a000
y.create.l HWIO_USB30_USB30_BAM_P_CTRL4_ADDR A:0x68b1b000
y.create.l HWIO_USB30_USB30_BAM_P_CTRL5_ADDR A:0x68b1c000
y.create.l HWIO_USB30_USB30_BAM_P_CTRL6_ADDR A:0x68b1d000
y.create.l HWIO_USB30_USB30_BAM_P_CTRL7_ADDR A:0x68b1e000
y.create.l HWIO_USB30_USB30_BAM_P_RST0_ADDR A:0x68b17004
y.create.l HWIO_USB30_USB30_BAM_P_RST1_ADDR A:0x68b18004
y.create.l HWIO_USB30_USB30_BAM_P_RST2_ADDR A:0x68b19004
y.create.l HWIO_USB30_USB30_BAM_P_RST3_ADDR A:0x68b1a004
y.create.l HWIO_USB30_USB30_BAM_P_RST4_ADDR A:0x68b1b004
y.create.l HWIO_USB30_USB30_BAM_P_RST5_ADDR A:0x68b1c004
y.create.l HWIO_USB30_USB30_BAM_P_RST6_ADDR A:0x68b1d004
y.create.l HWIO_USB30_USB30_BAM_P_RST7_ADDR A:0x68b1e004
y.create.l HWIO_USB30_USB30_BAM_P_HALT0_ADDR A:0x68b17008
y.create.l HWIO_USB30_USB30_BAM_P_HALT1_ADDR A:0x68b18008
y.create.l HWIO_USB30_USB30_BAM_P_HALT2_ADDR A:0x68b19008
y.create.l HWIO_USB30_USB30_BAM_P_HALT3_ADDR A:0x68b1a008
y.create.l HWIO_USB30_USB30_BAM_P_HALT4_ADDR A:0x68b1b008
y.create.l HWIO_USB30_USB30_BAM_P_HALT5_ADDR A:0x68b1c008
y.create.l HWIO_USB30_USB30_BAM_P_HALT6_ADDR A:0x68b1d008
y.create.l HWIO_USB30_USB30_BAM_P_HALT7_ADDR A:0x68b1e008
y.create.l HWIO_USB30_USB30_BAM_P_IRQ_STTS0_ADDR A:0x68b17010
y.create.l HWIO_USB30_USB30_BAM_P_IRQ_STTS1_ADDR A:0x68b18010
y.create.l HWIO_USB30_USB30_BAM_P_IRQ_STTS2_ADDR A:0x68b19010
y.create.l HWIO_USB30_USB30_BAM_P_IRQ_STTS3_ADDR A:0x68b1a010
y.create.l HWIO_USB30_USB30_BAM_P_IRQ_STTS4_ADDR A:0x68b1b010
y.create.l HWIO_USB30_USB30_BAM_P_IRQ_STTS5_ADDR A:0x68b1c010
y.create.l HWIO_USB30_USB30_BAM_P_IRQ_STTS6_ADDR A:0x68b1d010
y.create.l HWIO_USB30_USB30_BAM_P_IRQ_STTS7_ADDR A:0x68b1e010
y.create.l HWIO_USB30_USB30_BAM_P_IRQ_CLR0_ADDR A:0x68b17014
y.create.l HWIO_USB30_USB30_BAM_P_IRQ_CLR1_ADDR A:0x68b18014
y.create.l HWIO_USB30_USB30_BAM_P_IRQ_CLR2_ADDR A:0x68b19014
y.create.l HWIO_USB30_USB30_BAM_P_IRQ_CLR3_ADDR A:0x68b1a014
y.create.l HWIO_USB30_USB30_BAM_P_IRQ_CLR4_ADDR A:0x68b1b014
y.create.l HWIO_USB30_USB30_BAM_P_IRQ_CLR5_ADDR A:0x68b1c014
y.create.l HWIO_USB30_USB30_BAM_P_IRQ_CLR6_ADDR A:0x68b1d014
y.create.l HWIO_USB30_USB30_BAM_P_IRQ_CLR7_ADDR A:0x68b1e014
y.create.l HWIO_USB30_USB30_BAM_P_IRQ_EN0_ADDR A:0x68b17018
y.create.l HWIO_USB30_USB30_BAM_P_IRQ_EN1_ADDR A:0x68b18018
y.create.l HWIO_USB30_USB30_BAM_P_IRQ_EN2_ADDR A:0x68b19018
y.create.l HWIO_USB30_USB30_BAM_P_IRQ_EN3_ADDR A:0x68b1a018
y.create.l HWIO_USB30_USB30_BAM_P_IRQ_EN4_ADDR A:0x68b1b018
y.create.l HWIO_USB30_USB30_BAM_P_IRQ_EN5_ADDR A:0x68b1c018
y.create.l HWIO_USB30_USB30_BAM_P_IRQ_EN6_ADDR A:0x68b1d018
y.create.l HWIO_USB30_USB30_BAM_P_IRQ_EN7_ADDR A:0x68b1e018
y.create.l HWIO_USB30_USB30_BAM_P_TIMER0_ADDR A:0x68b1701c
y.create.l HWIO_USB30_USB30_BAM_P_TIMER1_ADDR A:0x68b1801c
y.create.l HWIO_USB30_USB30_BAM_P_TIMER2_ADDR A:0x68b1901c
y.create.l HWIO_USB30_USB30_BAM_P_TIMER3_ADDR A:0x68b1a01c
y.create.l HWIO_USB30_USB30_BAM_P_TIMER4_ADDR A:0x68b1b01c
y.create.l HWIO_USB30_USB30_BAM_P_TIMER5_ADDR A:0x68b1c01c
y.create.l HWIO_USB30_USB30_BAM_P_TIMER6_ADDR A:0x68b1d01c
y.create.l HWIO_USB30_USB30_BAM_P_TIMER7_ADDR A:0x68b1e01c
y.create.l HWIO_USB30_USB30_BAM_P_TIMER_CTRL0_ADDR A:0x68b17020
y.create.l HWIO_USB30_USB30_BAM_P_TIMER_CTRL1_ADDR A:0x68b18020
y.create.l HWIO_USB30_USB30_BAM_P_TIMER_CTRL2_ADDR A:0x68b19020
y.create.l HWIO_USB30_USB30_BAM_P_TIMER_CTRL3_ADDR A:0x68b1a020
y.create.l HWIO_USB30_USB30_BAM_P_TIMER_CTRL4_ADDR A:0x68b1b020
y.create.l HWIO_USB30_USB30_BAM_P_TIMER_CTRL5_ADDR A:0x68b1c020
y.create.l HWIO_USB30_USB30_BAM_P_TIMER_CTRL6_ADDR A:0x68b1d020
y.create.l HWIO_USB30_USB30_BAM_P_TIMER_CTRL7_ADDR A:0x68b1e020
y.create.l HWIO_USB30_USB30_BAM_P_PRDCR_SDBND0_ADDR A:0x68b17024
y.create.l HWIO_USB30_USB30_BAM_P_PRDCR_SDBND1_ADDR A:0x68b18024
y.create.l HWIO_USB30_USB30_BAM_P_PRDCR_SDBND2_ADDR A:0x68b19024
y.create.l HWIO_USB30_USB30_BAM_P_PRDCR_SDBND3_ADDR A:0x68b1a024
y.create.l HWIO_USB30_USB30_BAM_P_PRDCR_SDBND4_ADDR A:0x68b1b024
y.create.l HWIO_USB30_USB30_BAM_P_PRDCR_SDBND5_ADDR A:0x68b1c024
y.create.l HWIO_USB30_USB30_BAM_P_PRDCR_SDBND6_ADDR A:0x68b1d024
y.create.l HWIO_USB30_USB30_BAM_P_PRDCR_SDBND7_ADDR A:0x68b1e024
y.create.l HWIO_USB30_USB30_BAM_P_CNSMR_SDBND0_ADDR A:0x68b17028
y.create.l HWIO_USB30_USB30_BAM_P_CNSMR_SDBND1_ADDR A:0x68b18028
y.create.l HWIO_USB30_USB30_BAM_P_CNSMR_SDBND2_ADDR A:0x68b19028
y.create.l HWIO_USB30_USB30_BAM_P_CNSMR_SDBND3_ADDR A:0x68b1a028
y.create.l HWIO_USB30_USB30_BAM_P_CNSMR_SDBND4_ADDR A:0x68b1b028
y.create.l HWIO_USB30_USB30_BAM_P_CNSMR_SDBND5_ADDR A:0x68b1c028
y.create.l HWIO_USB30_USB30_BAM_P_CNSMR_SDBND6_ADDR A:0x68b1d028
y.create.l HWIO_USB30_USB30_BAM_P_CNSMR_SDBND7_ADDR A:0x68b1e028
y.create.l HWIO_USB30_USB30_BAM_P_SW_OFSTS0_ADDR A:0x68b17800
y.create.l HWIO_USB30_USB30_BAM_P_SW_OFSTS1_ADDR A:0x68b18800
y.create.l HWIO_USB30_USB30_BAM_P_SW_OFSTS2_ADDR A:0x68b19800
y.create.l HWIO_USB30_USB30_BAM_P_SW_OFSTS3_ADDR A:0x68b1a800
y.create.l HWIO_USB30_USB30_BAM_P_SW_OFSTS4_ADDR A:0x68b1b800
y.create.l HWIO_USB30_USB30_BAM_P_SW_OFSTS5_ADDR A:0x68b1c800
y.create.l HWIO_USB30_USB30_BAM_P_SW_OFSTS6_ADDR A:0x68b1d800
y.create.l HWIO_USB30_USB30_BAM_P_SW_OFSTS7_ADDR A:0x68b1e800
y.create.l HWIO_USB30_USB30_BAM_P_AU_PSM_CNTXT_1_0_ADDR A:0x68b17804
y.create.l HWIO_USB30_USB30_BAM_P_AU_PSM_CNTXT_1_1_ADDR A:0x68b18804
y.create.l HWIO_USB30_USB30_BAM_P_AU_PSM_CNTXT_1_2_ADDR A:0x68b19804
y.create.l HWIO_USB30_USB30_BAM_P_AU_PSM_CNTXT_1_3_ADDR A:0x68b1a804
y.create.l HWIO_USB30_USB30_BAM_P_AU_PSM_CNTXT_1_4_ADDR A:0x68b1b804
y.create.l HWIO_USB30_USB30_BAM_P_AU_PSM_CNTXT_1_5_ADDR A:0x68b1c804
y.create.l HWIO_USB30_USB30_BAM_P_AU_PSM_CNTXT_1_6_ADDR A:0x68b1d804
y.create.l HWIO_USB30_USB30_BAM_P_AU_PSM_CNTXT_1_7_ADDR A:0x68b1e804
y.create.l HWIO_USB30_USB30_BAM_P_PSM_CNTXT_2_0_ADDR A:0x68b17808
y.create.l HWIO_USB30_USB30_BAM_P_PSM_CNTXT_2_1_ADDR A:0x68b18808
y.create.l HWIO_USB30_USB30_BAM_P_PSM_CNTXT_2_2_ADDR A:0x68b19808
y.create.l HWIO_USB30_USB30_BAM_P_PSM_CNTXT_2_3_ADDR A:0x68b1a808
y.create.l HWIO_USB30_USB30_BAM_P_PSM_CNTXT_2_4_ADDR A:0x68b1b808
y.create.l HWIO_USB30_USB30_BAM_P_PSM_CNTXT_2_5_ADDR A:0x68b1c808
y.create.l HWIO_USB30_USB30_BAM_P_PSM_CNTXT_2_6_ADDR A:0x68b1d808
y.create.l HWIO_USB30_USB30_BAM_P_PSM_CNTXT_2_7_ADDR A:0x68b1e808
y.create.l HWIO_USB30_USB30_BAM_P_PSM_CNTXT_3_0_ADDR A:0x68b1780c
y.create.l HWIO_USB30_USB30_BAM_P_PSM_CNTXT_3_1_ADDR A:0x68b1880c
y.create.l HWIO_USB30_USB30_BAM_P_PSM_CNTXT_3_2_ADDR A:0x68b1980c
y.create.l HWIO_USB30_USB30_BAM_P_PSM_CNTXT_3_3_ADDR A:0x68b1a80c
y.create.l HWIO_USB30_USB30_BAM_P_PSM_CNTXT_3_4_ADDR A:0x68b1b80c
y.create.l HWIO_USB30_USB30_BAM_P_PSM_CNTXT_3_5_ADDR A:0x68b1c80c
y.create.l HWIO_USB30_USB30_BAM_P_PSM_CNTXT_3_6_ADDR A:0x68b1d80c
y.create.l HWIO_USB30_USB30_BAM_P_PSM_CNTXT_3_7_ADDR A:0x68b1e80c
y.create.l HWIO_USB30_USB30_BAM_P_PSM_CNTXT_4_0_ADDR A:0x68b17810
y.create.l HWIO_USB30_USB30_BAM_P_PSM_CNTXT_4_1_ADDR A:0x68b18810
y.create.l HWIO_USB30_USB30_BAM_P_PSM_CNTXT_4_2_ADDR A:0x68b19810
y.create.l HWIO_USB30_USB30_BAM_P_PSM_CNTXT_4_3_ADDR A:0x68b1a810
y.create.l HWIO_USB30_USB30_BAM_P_PSM_CNTXT_4_4_ADDR A:0x68b1b810
y.create.l HWIO_USB30_USB30_BAM_P_PSM_CNTXT_4_5_ADDR A:0x68b1c810
y.create.l HWIO_USB30_USB30_BAM_P_PSM_CNTXT_4_6_ADDR A:0x68b1d810
y.create.l HWIO_USB30_USB30_BAM_P_PSM_CNTXT_4_7_ADDR A:0x68b1e810
y.create.l HWIO_USB30_USB30_BAM_P_PSM_CNTXT_5_0_ADDR A:0x68b17814
y.create.l HWIO_USB30_USB30_BAM_P_PSM_CNTXT_5_1_ADDR A:0x68b18814
y.create.l HWIO_USB30_USB30_BAM_P_PSM_CNTXT_5_2_ADDR A:0x68b19814
y.create.l HWIO_USB30_USB30_BAM_P_PSM_CNTXT_5_3_ADDR A:0x68b1a814
y.create.l HWIO_USB30_USB30_BAM_P_PSM_CNTXT_5_4_ADDR A:0x68b1b814
y.create.l HWIO_USB30_USB30_BAM_P_PSM_CNTXT_5_5_ADDR A:0x68b1c814
y.create.l HWIO_USB30_USB30_BAM_P_PSM_CNTXT_5_6_ADDR A:0x68b1d814
y.create.l HWIO_USB30_USB30_BAM_P_PSM_CNTXT_5_7_ADDR A:0x68b1e814
y.create.l HWIO_USB30_USB30_BAM_P_EVNT_REG0_ADDR A:0x68b17818
y.create.l HWIO_USB30_USB30_BAM_P_EVNT_REG1_ADDR A:0x68b18818
y.create.l HWIO_USB30_USB30_BAM_P_EVNT_REG2_ADDR A:0x68b19818
y.create.l HWIO_USB30_USB30_BAM_P_EVNT_REG3_ADDR A:0x68b1a818
y.create.l HWIO_USB30_USB30_BAM_P_EVNT_REG4_ADDR A:0x68b1b818
y.create.l HWIO_USB30_USB30_BAM_P_EVNT_REG5_ADDR A:0x68b1c818
y.create.l HWIO_USB30_USB30_BAM_P_EVNT_REG6_ADDR A:0x68b1d818
y.create.l HWIO_USB30_USB30_BAM_P_EVNT_REG7_ADDR A:0x68b1e818
y.create.l HWIO_USB30_USB30_BAM_P_DESC_FIFO_ADDR0_ADDR A:0x68b1781c
y.create.l HWIO_USB30_USB30_BAM_P_DESC_FIFO_ADDR1_ADDR A:0x68b1881c
y.create.l HWIO_USB30_USB30_BAM_P_DESC_FIFO_ADDR2_ADDR A:0x68b1981c
y.create.l HWIO_USB30_USB30_BAM_P_DESC_FIFO_ADDR3_ADDR A:0x68b1a81c
y.create.l HWIO_USB30_USB30_BAM_P_DESC_FIFO_ADDR4_ADDR A:0x68b1b81c
y.create.l HWIO_USB30_USB30_BAM_P_DESC_FIFO_ADDR5_ADDR A:0x68b1c81c
y.create.l HWIO_USB30_USB30_BAM_P_DESC_FIFO_ADDR6_ADDR A:0x68b1d81c
y.create.l HWIO_USB30_USB30_BAM_P_DESC_FIFO_ADDR7_ADDR A:0x68b1e81c
y.create.l HWIO_USB30_USB30_BAM_P_FIFO_SIZES0_ADDR A:0x68b17820
y.create.l HWIO_USB30_USB30_BAM_P_FIFO_SIZES1_ADDR A:0x68b18820
y.create.l HWIO_USB30_USB30_BAM_P_FIFO_SIZES2_ADDR A:0x68b19820
y.create.l HWIO_USB30_USB30_BAM_P_FIFO_SIZES3_ADDR A:0x68b1a820
y.create.l HWIO_USB30_USB30_BAM_P_FIFO_SIZES4_ADDR A:0x68b1b820
y.create.l HWIO_USB30_USB30_BAM_P_FIFO_SIZES5_ADDR A:0x68b1c820
y.create.l HWIO_USB30_USB30_BAM_P_FIFO_SIZES6_ADDR A:0x68b1d820
y.create.l HWIO_USB30_USB30_BAM_P_FIFO_SIZES7_ADDR A:0x68b1e820
y.create.l HWIO_USB30_USB30_BAM_P_DATA_FIFO_ADDR0_ADDR A:0x68b17824
y.create.l HWIO_USB30_USB30_BAM_P_DATA_FIFO_ADDR1_ADDR A:0x68b18824
y.create.l HWIO_USB30_USB30_BAM_P_DATA_FIFO_ADDR2_ADDR A:0x68b19824
y.create.l HWIO_USB30_USB30_BAM_P_DATA_FIFO_ADDR3_ADDR A:0x68b1a824
y.create.l HWIO_USB30_USB30_BAM_P_DATA_FIFO_ADDR4_ADDR A:0x68b1b824
y.create.l HWIO_USB30_USB30_BAM_P_DATA_FIFO_ADDR5_ADDR A:0x68b1c824
y.create.l HWIO_USB30_USB30_BAM_P_DATA_FIFO_ADDR6_ADDR A:0x68b1d824
y.create.l HWIO_USB30_USB30_BAM_P_DATA_FIFO_ADDR7_ADDR A:0x68b1e824
y.create.l HWIO_USB30_USB30_BAM_P_EVNT_GEN_TRSHLD0_ADDR A:0x68b17828
y.create.l HWIO_USB30_USB30_BAM_P_EVNT_GEN_TRSHLD1_ADDR A:0x68b18828
y.create.l HWIO_USB30_USB30_BAM_P_EVNT_GEN_TRSHLD2_ADDR A:0x68b19828
y.create.l HWIO_USB30_USB30_BAM_P_EVNT_GEN_TRSHLD3_ADDR A:0x68b1a828
y.create.l HWIO_USB30_USB30_BAM_P_EVNT_GEN_TRSHLD4_ADDR A:0x68b1b828
y.create.l HWIO_USB30_USB30_BAM_P_EVNT_GEN_TRSHLD5_ADDR A:0x68b1c828
y.create.l HWIO_USB30_USB30_BAM_P_EVNT_GEN_TRSHLD6_ADDR A:0x68b1d828
y.create.l HWIO_USB30_USB30_BAM_P_EVNT_GEN_TRSHLD7_ADDR A:0x68b1e828
y.create.l HWIO_USB30_USB30_BAM_P_EVNT_DEST_ADDR0_ADDR A:0x68b1782c
y.create.l HWIO_USB30_USB30_BAM_P_EVNT_DEST_ADDR1_ADDR A:0x68b1882c
y.create.l HWIO_USB30_USB30_BAM_P_EVNT_DEST_ADDR2_ADDR A:0x68b1982c
y.create.l HWIO_USB30_USB30_BAM_P_EVNT_DEST_ADDR3_ADDR A:0x68b1a82c
y.create.l HWIO_USB30_USB30_BAM_P_EVNT_DEST_ADDR4_ADDR A:0x68b1b82c
y.create.l HWIO_USB30_USB30_BAM_P_EVNT_DEST_ADDR5_ADDR A:0x68b1c82c
y.create.l HWIO_USB30_USB30_BAM_P_EVNT_DEST_ADDR6_ADDR A:0x68b1d82c
y.create.l HWIO_USB30_USB30_BAM_P_EVNT_DEST_ADDR7_ADDR A:0x68b1e82c
y.create.l HWIO_USB30_USB30_BAM_P_DF_CNTXT_0_ADDR A:0x68b17830
y.create.l HWIO_USB30_USB30_BAM_P_DF_CNTXT_1_ADDR A:0x68b18830
y.create.l HWIO_USB30_USB30_BAM_P_DF_CNTXT_2_ADDR A:0x68b19830
y.create.l HWIO_USB30_USB30_BAM_P_DF_CNTXT_3_ADDR A:0x68b1a830
y.create.l HWIO_USB30_USB30_BAM_P_DF_CNTXT_4_ADDR A:0x68b1b830
y.create.l HWIO_USB30_USB30_BAM_P_DF_CNTXT_5_ADDR A:0x68b1c830
y.create.l HWIO_USB30_USB30_BAM_P_DF_CNTXT_6_ADDR A:0x68b1d830
y.create.l HWIO_USB30_USB30_BAM_P_DF_CNTXT_7_ADDR A:0x68b1e830
y.create.l HWIO_USB30_USB30_BAM_P_RETR_CNTXT_0_ADDR A:0x68b17834
y.create.l HWIO_USB30_USB30_BAM_P_RETR_CNTXT_1_ADDR A:0x68b18834
y.create.l HWIO_USB30_USB30_BAM_P_RETR_CNTXT_2_ADDR A:0x68b19834
y.create.l HWIO_USB30_USB30_BAM_P_RETR_CNTXT_3_ADDR A:0x68b1a834
y.create.l HWIO_USB30_USB30_BAM_P_RETR_CNTXT_4_ADDR A:0x68b1b834
y.create.l HWIO_USB30_USB30_BAM_P_RETR_CNTXT_5_ADDR A:0x68b1c834
y.create.l HWIO_USB30_USB30_BAM_P_RETR_CNTXT_6_ADDR A:0x68b1d834
y.create.l HWIO_USB30_USB30_BAM_P_RETR_CNTXT_7_ADDR A:0x68b1e834
y.create.l HWIO_USB30_USB30_BAM_P_SI_CNTXT_0_ADDR A:0x68b17838
y.create.l HWIO_USB30_USB30_BAM_P_SI_CNTXT_1_ADDR A:0x68b18838
y.create.l HWIO_USB30_USB30_BAM_P_SI_CNTXT_2_ADDR A:0x68b19838
y.create.l HWIO_USB30_USB30_BAM_P_SI_CNTXT_3_ADDR A:0x68b1a838
y.create.l HWIO_USB30_USB30_BAM_P_SI_CNTXT_4_ADDR A:0x68b1b838
y.create.l HWIO_USB30_USB30_BAM_P_SI_CNTXT_5_ADDR A:0x68b1c838
y.create.l HWIO_USB30_USB30_BAM_P_SI_CNTXT_6_ADDR A:0x68b1d838
y.create.l HWIO_USB30_USB30_BAM_P_SI_CNTXT_7_ADDR A:0x68b1e838
y.create.l HWIO_USB30_USB30_BAM_P_PSM_CNTXT_3_LSB0_ADDR A:0x68b17900
y.create.l HWIO_USB30_USB30_BAM_P_PSM_CNTXT_3_LSB1_ADDR A:0x68b18900
y.create.l HWIO_USB30_USB30_BAM_P_PSM_CNTXT_3_LSB2_ADDR A:0x68b19900
y.create.l HWIO_USB30_USB30_BAM_P_PSM_CNTXT_3_LSB3_ADDR A:0x68b1a900
y.create.l HWIO_USB30_USB30_BAM_P_PSM_CNTXT_3_LSB4_ADDR A:0x68b1b900
y.create.l HWIO_USB30_USB30_BAM_P_PSM_CNTXT_3_LSB5_ADDR A:0x68b1c900
y.create.l HWIO_USB30_USB30_BAM_P_PSM_CNTXT_3_LSB6_ADDR A:0x68b1d900
y.create.l HWIO_USB30_USB30_BAM_P_PSM_CNTXT_3_LSB7_ADDR A:0x68b1e900
y.create.l HWIO_USB30_USB30_BAM_P_PSM_CNTXT_3_MSB0_ADDR A:0x68b17904
y.create.l HWIO_USB30_USB30_BAM_P_PSM_CNTXT_3_MSB1_ADDR A:0x68b18904
y.create.l HWIO_USB30_USB30_BAM_P_PSM_CNTXT_3_MSB2_ADDR A:0x68b19904
y.create.l HWIO_USB30_USB30_BAM_P_PSM_CNTXT_3_MSB3_ADDR A:0x68b1a904
y.create.l HWIO_USB30_USB30_BAM_P_PSM_CNTXT_3_MSB4_ADDR A:0x68b1b904
y.create.l HWIO_USB30_USB30_BAM_P_PSM_CNTXT_3_MSB5_ADDR A:0x68b1c904
y.create.l HWIO_USB30_USB30_BAM_P_PSM_CNTXT_3_MSB6_ADDR A:0x68b1d904
y.create.l HWIO_USB30_USB30_BAM_P_PSM_CNTXT_3_MSB7_ADDR A:0x68b1e904
y.create.l HWIO_USB30_USB30_BAM_P_DESC_FIFO_ADDR_LSB0_ADDR A:0x68b17910
y.create.l HWIO_USB30_USB30_BAM_P_DESC_FIFO_ADDR_LSB1_ADDR A:0x68b18910
y.create.l HWIO_USB30_USB30_BAM_P_DESC_FIFO_ADDR_LSB2_ADDR A:0x68b19910
y.create.l HWIO_USB30_USB30_BAM_P_DESC_FIFO_ADDR_LSB3_ADDR A:0x68b1a910
y.create.l HWIO_USB30_USB30_BAM_P_DESC_FIFO_ADDR_LSB4_ADDR A:0x68b1b910
y.create.l HWIO_USB30_USB30_BAM_P_DESC_FIFO_ADDR_LSB5_ADDR A:0x68b1c910
y.create.l HWIO_USB30_USB30_BAM_P_DESC_FIFO_ADDR_LSB6_ADDR A:0x68b1d910
y.create.l HWIO_USB30_USB30_BAM_P_DESC_FIFO_ADDR_LSB7_ADDR A:0x68b1e910
y.create.l HWIO_USB30_USB30_BAM_P_DESC_FIFO_ADDR_MSB0_ADDR A:0x68b17914
y.create.l HWIO_USB30_USB30_BAM_P_DESC_FIFO_ADDR_MSB1_ADDR A:0x68b18914
y.create.l HWIO_USB30_USB30_BAM_P_DESC_FIFO_ADDR_MSB2_ADDR A:0x68b19914
y.create.l HWIO_USB30_USB30_BAM_P_DESC_FIFO_ADDR_MSB3_ADDR A:0x68b1a914
y.create.l HWIO_USB30_USB30_BAM_P_DESC_FIFO_ADDR_MSB4_ADDR A:0x68b1b914
y.create.l HWIO_USB30_USB30_BAM_P_DESC_FIFO_ADDR_MSB5_ADDR A:0x68b1c914
y.create.l HWIO_USB30_USB30_BAM_P_DESC_FIFO_ADDR_MSB6_ADDR A:0x68b1d914
y.create.l HWIO_USB30_USB30_BAM_P_DESC_FIFO_ADDR_MSB7_ADDR A:0x68b1e914
y.create.l HWIO_USB30_USB30_BAM_P_DATA_FIFO_ADDR_LSB0_ADDR A:0x68b17920
y.create.l HWIO_USB30_USB30_BAM_P_DATA_FIFO_ADDR_LSB1_ADDR A:0x68b18920
y.create.l HWIO_USB30_USB30_BAM_P_DATA_FIFO_ADDR_LSB2_ADDR A:0x68b19920
y.create.l HWIO_USB30_USB30_BAM_P_DATA_FIFO_ADDR_LSB3_ADDR A:0x68b1a920
y.create.l HWIO_USB30_USB30_BAM_P_DATA_FIFO_ADDR_LSB4_ADDR A:0x68b1b920
y.create.l HWIO_USB30_USB30_BAM_P_DATA_FIFO_ADDR_LSB5_ADDR A:0x68b1c920
y.create.l HWIO_USB30_USB30_BAM_P_DATA_FIFO_ADDR_LSB6_ADDR A:0x68b1d920
y.create.l HWIO_USB30_USB30_BAM_P_DATA_FIFO_ADDR_LSB7_ADDR A:0x68b1e920
y.create.l HWIO_USB30_USB30_BAM_P_DATA_FIFO_ADDR_MSB0_ADDR A:0x68b17924
y.create.l HWIO_USB30_USB30_BAM_P_DATA_FIFO_ADDR_MSB1_ADDR A:0x68b18924
y.create.l HWIO_USB30_USB30_BAM_P_DATA_FIFO_ADDR_MSB2_ADDR A:0x68b19924
y.create.l HWIO_USB30_USB30_BAM_P_DATA_FIFO_ADDR_MSB3_ADDR A:0x68b1a924
y.create.l HWIO_USB30_USB30_BAM_P_DATA_FIFO_ADDR_MSB4_ADDR A:0x68b1b924
y.create.l HWIO_USB30_USB30_BAM_P_DATA_FIFO_ADDR_MSB5_ADDR A:0x68b1c924
y.create.l HWIO_USB30_USB30_BAM_P_DATA_FIFO_ADDR_MSB6_ADDR A:0x68b1d924
y.create.l HWIO_USB30_USB30_BAM_P_DATA_FIFO_ADDR_MSB7_ADDR A:0x68b1e924
y.create.l HWIO_USB30_USB30_BAM_P_EVNT_DEST_ADDR_LSB0_ADDR A:0x68b17930
y.create.l HWIO_USB30_USB30_BAM_P_EVNT_DEST_ADDR_LSB1_ADDR A:0x68b18930
y.create.l HWIO_USB30_USB30_BAM_P_EVNT_DEST_ADDR_LSB2_ADDR A:0x68b19930
y.create.l HWIO_USB30_USB30_BAM_P_EVNT_DEST_ADDR_LSB3_ADDR A:0x68b1a930
y.create.l HWIO_USB30_USB30_BAM_P_EVNT_DEST_ADDR_LSB4_ADDR A:0x68b1b930
y.create.l HWIO_USB30_USB30_BAM_P_EVNT_DEST_ADDR_LSB5_ADDR A:0x68b1c930
y.create.l HWIO_USB30_USB30_BAM_P_EVNT_DEST_ADDR_LSB6_ADDR A:0x68b1d930
y.create.l HWIO_USB30_USB30_BAM_P_EVNT_DEST_ADDR_LSB7_ADDR A:0x68b1e930
y.create.l HWIO_USB30_USB30_BAM_P_EVNT_DEST_ADDR_MSB0_ADDR A:0x68b17934
y.create.l HWIO_USB30_USB30_BAM_P_EVNT_DEST_ADDR_MSB1_ADDR A:0x68b18934
y.create.l HWIO_USB30_USB30_BAM_P_EVNT_DEST_ADDR_MSB2_ADDR A:0x68b19934
y.create.l HWIO_USB30_USB30_BAM_P_EVNT_DEST_ADDR_MSB3_ADDR A:0x68b1a934
y.create.l HWIO_USB30_USB30_BAM_P_EVNT_DEST_ADDR_MSB4_ADDR A:0x68b1b934
y.create.l HWIO_USB30_USB30_BAM_P_EVNT_DEST_ADDR_MSB5_ADDR A:0x68b1c934
y.create.l HWIO_USB30_USB30_BAM_P_EVNT_DEST_ADDR_MSB6_ADDR A:0x68b1d934
y.create.l HWIO_USB30_USB30_BAM_P_EVNT_DEST_ADDR_MSB7_ADDR A:0x68b1e934
y.create.l HWIO_QUSB2PHY_QUSB2PHY_PLL_ADDR A:0x60079000
y.create.l HWIO_QUSB2PHY_QUSB2PHY_PLL_TEST1_ADDR A:0x60079004
y.create.l HWIO_QUSB2PHY_QUSB2PHY_PLL_TEST2_ADDR A:0x60079008
y.create.l HWIO_QUSB2PHY_QUSB2PHY_PLL_USER_CTL1_ADDR A:0x6007900c
y.create.l HWIO_QUSB2PHY_QUSB2PHY_PLL_USER_CTL2_ADDR A:0x60079010
y.create.l HWIO_QUSB2PHY_QUSB2PHY_PLL_CONFIG_CTL_ADDR A:0x60079014
y.create.l HWIO_QUSB2PHY_QUSB2PHY_PLL_PWR_CTL_ADDR A:0x60079018
y.create.l HWIO_QUSB2PHY_QUSB2PHY_PLL_AUTOPGM_CTL1_ADDR A:0x6007901c
y.create.l HWIO_QUSB2PHY_QUSB2PHY_PLL_AUTOPGM_CTL2_ADDR A:0x60079020
y.create.l HWIO_QUSB2PHY_QUSB2PHY_HM_OBSV_CTL1_ADDR A:0x60079024
y.create.l HWIO_QUSB2PHY_QUSB2PHY_HM_OBSV_CTL2_ADDR A:0x60079028
y.create.l HWIO_QUSB2PHY_QUSB2PHY_HM_OBSV_CTL3_ADDR A:0x6007902c
y.create.l HWIO_QUSB2PHY_QUSB2PHY_HM_OBSV_CTL4_ADDR A:0x60079030
y.create.l HWIO_QUSB2PHY_QUSB2PHY_COM_SPARE_WR_REG0_ADDR A:0x60079034
y.create.l HWIO_QUSB2PHY_QUSB2PHY_PLL_STATUS_ADDR A:0x60079038
y.create.l HWIO_QUSB2PHY_QUSB2PHY_COM_SPARE_RO_REG0_ADDR A:0x6007903c
y.create.l HWIO_QUSB2PHY_QUSB2PHY_REVISION_ID0_ADDR A:0x60079040
y.create.l HWIO_QUSB2PHY_QUSB2PHY_REVISION_ID1_ADDR A:0x60079044
y.create.l HWIO_QUSB2PHY_QUSB2PHY_REVISION_ID2_ADDR A:0x60079048
y.create.l HWIO_QUSB2PHY_QUSB2PHY_REVISION_ID3_ADDR A:0x6007904c
y.create.l HWIO_QUSB2PHY_QUSB2PHY_DEBUG_BUS_STATUS0_ADDR A:0x60079050
y.create.l HWIO_QUSB2PHY_QUSB2PHY_DEBUG_BUS_STATUS1_ADDR A:0x60079054
y.create.l HWIO_QUSB2PHY_QUSB2PHY_DEBUG_BUS_STATUS2_ADDR A:0x60079058
y.create.l HWIO_QUSB2PHY_QUSB2PHY_DEBUG_BUS_STATUS3_ADDR A:0x6007905c
y.create.l HWIO_QUSB2PHY_QUSB2PHY_PORT_QUICKCHARGE1_ADDR A:0x60079070
y.create.l HWIO_QUSB2PHY_QUSB2PHY_PORT_QUICKCHARGE2_ADDR A:0x60079074
y.create.l HWIO_QUSB2PHY_QUSB2PHY_PORT_TUNE1_ADDR A:0x60079080
y.create.l HWIO_QUSB2PHY_QUSB2PHY_PORT_TUNE2_ADDR A:0x60079084
y.create.l HWIO_QUSB2PHY_QUSB2PHY_PORT_TUNE3_ADDR A:0x60079088
y.create.l HWIO_QUSB2PHY_QUSB2PHY_PORT_TUNE4_ADDR A:0x6007908c
y.create.l HWIO_QUSB2PHY_QUSB2PHY_PORT_SPARE_WR_REG3_ADDR A:0x60079090
y.create.l HWIO_QUSB2PHY_QUSB2PHY_PORT_CDR_TEST_ADDR A:0x60079094
y.create.l HWIO_QUSB2PHY_QUSB2PHY_PORT_TEST1_ADDR A:0x60079098
y.create.l HWIO_QUSB2PHY_QUSB2PHY_PORT_TEST2_ADDR A:0x6007909c
y.create.l HWIO_QUSB2PHY_QUSB2PHY_PORT_TEST3_ADDR A:0x600790a0
y.create.l HWIO_QUSB2PHY_QUSB2PHY_PORT_BYP1_ADDR A:0x600790a4
y.create.l HWIO_QUSB2PHY_QUSB2PHY_PORT_BYP2_ADDR A:0x600790a8
y.create.l HWIO_QUSB2PHY_QUSB2PHY_PORT_BYP3_ADDR A:0x600790ac
y.create.l HWIO_QUSB2PHY_QUSB2PHY_PORT_CDR_CTRL_ADDR A:0x600790b0
y.create.l HWIO_QUSB2PHY_QUSB2PHY_PORT_POWERDOWN_ADDR A:0x600790b4
y.create.l HWIO_QUSB2PHY_QUSB2PHY_PORT_TEST_CTRL_ADDR A:0x600790b8
y.create.l HWIO_QUSB2PHY_QUSB2PHY_PORT_INTR_CTRL_ADDR A:0x600790bc
y.create.l HWIO_QUSB2PHY_QUSB2PHY_PORT_UTMI_CTRL1_ADDR A:0x600790c0
y.create.l HWIO_QUSB2PHY_QUSB2PHY_PORT_UTMI_CTRL2_ADDR A:0x600790c4
y.create.l HWIO_QUSB2PHY_QUSB2PHY_PORT_UTMI_TX_DATA_ADDR A:0x600790c8
y.create.l HWIO_QUSB2PHY_QUSB2PHY_PORT_RX_PKT_VALUE0_ADDR A:0x600790cc
y.create.l HWIO_QUSB2PHY_QUSB2PHY_PORT_RX_PKT_VALUE1_ADDR A:0x600790d0
y.create.l HWIO_QUSB2PHY_QUSB2PHY_PORT_RX_PKT_VALUE2_ADDR A:0x600790d4
y.create.l HWIO_QUSB2PHY_QUSB2PHY_PORT_DEBUG_BUS_SEL_ADDR A:0x600790d8
y.create.l HWIO_QUSB2PHY_QUSB2PHY_PORT_ANALOG_TEST_SEL_ADDR A:0x600790dc
y.create.l HWIO_QUSB2PHY_QUSB2PHY_PORT_SPARE_WR_REG1_ADDR A:0x600790e0
y.create.l HWIO_QUSB2PHY_QUSB2PHY_PORT_OUTPUT_ADDR A:0x600790e4
y.create.l HWIO_QUSB2PHY_QUSB2PHY_PORT_RX_STATUS_ADDR A:0x600790e8
y.create.l HWIO_QUSB2PHY_QUSB2PHY_PORT_INTERNAL_STATUS_ADDR A:0x600790ec
y.create.l HWIO_QUSB2PHY_QUSB2PHY_PORT_INTR_STATUS_ADDR A:0x600790f0
y.create.l HWIO_QUSB2PHY_QUSB2PHY_PORT_UTMI_STATUS_ADDR A:0x600790f4
y.create.l HWIO_QUSB2PHY_QUSB2PHY_PORT_UTMI_RX_DATA_ADDR A:0x600790f8
y.create.l HWIO_QUSB2PHY_QUSB2PHY_PORT_UTMI_VSTATUS_ADDR A:0x600790fc
y.create.l HWIO_USB3PHY_QSERDES_COM_SYS_CLK_CTRL_ADDR A:0x60078000
y.create.l HWIO_USB3PHY_QSERDES_COM_PLL_VCOTAIL_EN_ADDR A:0x60078004
y.create.l HWIO_USB3PHY_QSERDES_COM_CMN_MODE_ADDR A:0x60078008
y.create.l HWIO_USB3PHY_QSERDES_COM_IE_TRIM_ADDR A:0x6007800c
y.create.l HWIO_USB3PHY_QSERDES_COM_IP_TRIM_ADDR A:0x60078010
y.create.l HWIO_USB3PHY_QSERDES_COM_PLL_CNTRL_ADDR A:0x60078014
y.create.l HWIO_USB3PHY_QSERDES_COM_PLL_PHSEL_CONTROL_ADDR A:0x60078018
y.create.l HWIO_USB3PHY_QSERDES_COM_IPTAT_TRIM_VCCA_TX_SEL_ADDR A:0x6007801c
y.create.l HWIO_USB3PHY_QSERDES_COM_PLL_PHSEL_DC_ADDR A:0x60078020
y.create.l HWIO_USB3PHY_QSERDES_COM_PLL_IP_SETI_ADDR A:0x60078024
y.create.l HWIO_USB3PHY_QSERDES_COM_CORE_CLK_IN_SYNC_SEL_ADDR A:0x60078028
y.create.l HWIO_USB3PHY_QSERDES_COM_PLL_BKG_KVCO_CAL_EN_ADDR A:0x6007802c
y.create.l HWIO_USB3PHY_QSERDES_COM_BIAS_EN_CLKBUFLR_EN_ADDR A:0x60078030
y.create.l HWIO_USB3PHY_QSERDES_COM_PLL_CP_SETI_ADDR A:0x60078034
y.create.l HWIO_USB3PHY_QSERDES_COM_PLL_IP_SETP_ADDR A:0x60078038
y.create.l HWIO_USB3PHY_QSERDES_COM_PLL_CP_SETP_ADDR A:0x6007803c
y.create.l HWIO_USB3PHY_QSERDES_COM_ATB_SEL1_ADDR A:0x60078040
y.create.l HWIO_USB3PHY_QSERDES_COM_ATB_SEL2_ADDR A:0x60078044
y.create.l HWIO_USB3PHY_QSERDES_COM_SYSCLK_EN_SEL_TXBAND_ADDR A:0x60078048
y.create.l HWIO_USB3PHY_QSERDES_COM_RESETSM_CNTRL_ADDR A:0x6007804c
y.create.l HWIO_USB3PHY_QSERDES_COM_RESETSM_CNTRL2_ADDR A:0x60078050
y.create.l HWIO_USB3PHY_QSERDES_COM_RESETSM_CNTRL3_ADDR A:0x60078054
y.create.l HWIO_USB3PHY_QSERDES_COM_RESETSM_PLL_CAL_COUNT1_ADDR A:0x60078058
y.create.l HWIO_USB3PHY_QSERDES_COM_RESETSM_PLL_CAL_COUNT2_ADDR A:0x6007805c
y.create.l HWIO_USB3PHY_QSERDES_COM_DIV_REF1_ADDR A:0x60078060
y.create.l HWIO_USB3PHY_QSERDES_COM_DIV_REF2_ADDR A:0x60078064
y.create.l HWIO_USB3PHY_QSERDES_COM_KVCO_COUNT1_ADDR A:0x60078068
y.create.l HWIO_USB3PHY_QSERDES_COM_KVCO_COUNT2_ADDR A:0x6007806c
y.create.l HWIO_USB3PHY_QSERDES_COM_KVCO_CAL_CNTRL_ADDR A:0x60078070
y.create.l HWIO_USB3PHY_QSERDES_COM_KVCO_CODE_ADDR A:0x60078074
y.create.l HWIO_USB3PHY_QSERDES_COM_VREF_CFG1_ADDR A:0x60078078
y.create.l HWIO_USB3PHY_QSERDES_COM_VREF_CFG2_ADDR A:0x6007807c
y.create.l HWIO_USB3PHY_QSERDES_COM_VREF_CFG3_ADDR A:0x60078080
y.create.l HWIO_USB3PHY_QSERDES_COM_VREF_CFG4_ADDR A:0x60078084
y.create.l HWIO_USB3PHY_QSERDES_COM_VREF_CFG5_ADDR A:0x60078088
y.create.l HWIO_USB3PHY_QSERDES_COM_VREF_CFG6_ADDR A:0x6007808c
y.create.l HWIO_USB3PHY_QSERDES_COM_PLLLOCK_CMP1_ADDR A:0x60078090
y.create.l HWIO_USB3PHY_QSERDES_COM_PLLLOCK_CMP2_ADDR A:0x60078094
y.create.l HWIO_USB3PHY_QSERDES_COM_PLLLOCK_CMP3_ADDR A:0x60078098
y.create.l HWIO_USB3PHY_QSERDES_COM_PLLLOCK_CMP_EN_ADDR A:0x6007809c
y.create.l HWIO_USB3PHY_QSERDES_COM_BGTC_ADDR A:0x600780a0
y.create.l HWIO_USB3PHY_QSERDES_COM_PLL_TEST_UPDN_ADDR A:0x600780a4
y.create.l HWIO_USB3PHY_QSERDES_COM_PLL_VCO_TUNE_ADDR A:0x600780a8
y.create.l HWIO_USB3PHY_QSERDES_COM_DEC_START1_ADDR A:0x600780ac
y.create.l HWIO_USB3PHY_QSERDES_COM_PLL_AMP_OS_ADDR A:0x600780b0
y.create.l HWIO_USB3PHY_QSERDES_COM_SSC_EN_CENTER_ADDR A:0x600780b4
y.create.l HWIO_USB3PHY_QSERDES_COM_SSC_ADJ_PER1_ADDR A:0x600780b8
y.create.l HWIO_USB3PHY_QSERDES_COM_SSC_ADJ_PER2_ADDR A:0x600780bc
y.create.l HWIO_USB3PHY_QSERDES_COM_SSC_PER1_ADDR A:0x600780c0
y.create.l HWIO_USB3PHY_QSERDES_COM_SSC_PER2_ADDR A:0x600780c4
y.create.l HWIO_USB3PHY_QSERDES_COM_SSC_STEP_SIZE1_ADDR A:0x600780c8
y.create.l HWIO_USB3PHY_QSERDES_COM_SSC_STEP_SIZE2_ADDR A:0x600780cc
y.create.l HWIO_USB3PHY_QSERDES_COM_RES_CODE_UP_ADDR A:0x600780d0
y.create.l HWIO_USB3PHY_QSERDES_COM_RES_CODE_DN_ADDR A:0x600780d4
y.create.l HWIO_USB3PHY_QSERDES_COM_RES_CODE_UP_OFFSET_ADDR A:0x600780d8
y.create.l HWIO_USB3PHY_QSERDES_COM_RES_CODE_DN_OFFSET_ADDR A:0x600780dc
y.create.l HWIO_USB3PHY_QSERDES_COM_RES_CODE_START_SEG1_ADDR A:0x600780e0
y.create.l HWIO_USB3PHY_QSERDES_COM_RES_CODE_START_SEG2_ADDR A:0x600780e4
y.create.l HWIO_USB3PHY_QSERDES_COM_RES_CODE_CAL_CSR_ADDR A:0x600780e8
y.create.l HWIO_USB3PHY_QSERDES_COM_RES_CODE_ADDR A:0x600780ec
y.create.l HWIO_USB3PHY_QSERDES_COM_RES_TRIM_CONTROL_ADDR A:0x600780f0
y.create.l HWIO_USB3PHY_QSERDES_COM_RES_TRIM_CONTROL2_ADDR A:0x600780f4
y.create.l HWIO_USB3PHY_QSERDES_COM_RES_TRIM_EN_VCOCALDONE_ADDR A:0x600780f8
y.create.l HWIO_USB3PHY_QSERDES_COM_FAUX_EN_ADDR A:0x600780fc
y.create.l HWIO_USB3PHY_QSERDES_COM_DIV_FRAC_START1_ADDR A:0x60078100
y.create.l HWIO_USB3PHY_QSERDES_COM_DIV_FRAC_START2_ADDR A:0x60078104
y.create.l HWIO_USB3PHY_QSERDES_COM_DIV_FRAC_START3_ADDR A:0x60078108
y.create.l HWIO_USB3PHY_QSERDES_COM_DEC_START2_ADDR A:0x6007810c
y.create.l HWIO_USB3PHY_QSERDES_COM_PLL_RXTXEPCLK_EN_ADDR A:0x60078110
y.create.l HWIO_USB3PHY_QSERDES_COM_PLL_CRCTRL_ADDR A:0x60078114
y.create.l HWIO_USB3PHY_QSERDES_COM_PLL_CLKEPDIV_ADDR A:0x60078118
y.create.l HWIO_USB3PHY_QSERDES_COM_PLL_FREQUPDATE_ADDR A:0x6007811c
y.create.l HWIO_USB3PHY_QSERDES_COM_PLL_BKGCAL_TRIM_UP_ADDR A:0x60078120
y.create.l HWIO_USB3PHY_QSERDES_COM_PLL_BKGCAL_TRIM_DN_ADDR A:0x60078124
y.create.l HWIO_USB3PHY_QSERDES_COM_PLL_BKGCAL_TRIM_MUX_ADDR A:0x60078128
y.create.l HWIO_USB3PHY_QSERDES_COM_PLL_BKGCAL_VREF_CFG_ADDR A:0x6007812c
y.create.l HWIO_USB3PHY_QSERDES_COM_PLL_BKGCAL_DIV_REF1_ADDR A:0x60078130
y.create.l HWIO_USB3PHY_QSERDES_COM_PLL_BKGCAL_DIV_REF2_ADDR A:0x60078134
y.create.l HWIO_USB3PHY_QSERDES_COM_MUXADDR_ADDR A:0x60078138
y.create.l HWIO_USB3PHY_QSERDES_COM_LOW_POWER_RO_CONTROL_ADDR A:0x6007813c
y.create.l HWIO_USB3PHY_QSERDES_COM_POST_DIVIDER_CONTROL_ADDR A:0x60078140
y.create.l HWIO_USB3PHY_QSERDES_COM_HR_OCLK2_DIVIDER_ADDR A:0x60078144
y.create.l HWIO_USB3PHY_QSERDES_COM_HR_OCLK3_DIVIDER_ADDR A:0x60078148
y.create.l HWIO_USB3PHY_QSERDES_COM_PLL_VCO_HIGH_ADDR A:0x6007814c
y.create.l HWIO_USB3PHY_QSERDES_COM_RESET_SM_ADDR A:0x60078150
y.create.l HWIO_USB3PHY_QSERDES_COM_MUXVAL_ADDR A:0x60078154
y.create.l HWIO_USB3PHY_QSERDES_COM_CORE_RES_CODE_DN_ADDR A:0x60078158
y.create.l HWIO_USB3PHY_QSERDES_COM_CORE_RES_CODE_UP_ADDR A:0x6007815c
y.create.l HWIO_USB3PHY_QSERDES_COM_CORE_VCO_TUNE_ADDR A:0x60078160
y.create.l HWIO_USB3PHY_QSERDES_COM_CORE_VCO_TAIL_ADDR A:0x60078164
y.create.l HWIO_USB3PHY_QSERDES_COM_CORE_KVCO_CODE_ADDR A:0x60078168
y.create.l HWIO_USB3PHY_QSERDES_TX_BIST_MODE_LANENO_ADDR A:0x60078200
y.create.l HWIO_USB3PHY_QSERDES_TX_CLKBUF_ENABLE_ADDR A:0x60078204
y.create.l HWIO_USB3PHY_QSERDES_TX_TX_EMP_POST1_LVL_ADDR A:0x60078208
y.create.l HWIO_USB3PHY_QSERDES_TX_TX_DRV_LVL_ADDR A:0x6007820c
y.create.l HWIO_USB3PHY_QSERDES_TX_RESET_TSYNC_EN_ADDR A:0x60078210
y.create.l HWIO_USB3PHY_QSERDES_TX_LPB_EN_ADDR A:0x60078214
y.create.l HWIO_USB3PHY_QSERDES_TX_RES_CODE_UP_ADDR A:0x60078218
y.create.l HWIO_USB3PHY_QSERDES_TX_RES_CODE_DN_ADDR A:0x6007821c
y.create.l HWIO_USB3PHY_QSERDES_TX_PERL_LENGTH1_ADDR A:0x60078220
y.create.l HWIO_USB3PHY_QSERDES_TX_PERL_LENGTH2_ADDR A:0x60078224
y.create.l HWIO_USB3PHY_QSERDES_TX_SERDES_BYP_EN_OUT_ADDR A:0x60078228
y.create.l HWIO_USB3PHY_QSERDES_TX_HIGHZ_TRANSCEIVEREN_BIAS_DRVR_EN_ADDR A:0x6007822c
y.create.l HWIO_USB3PHY_QSERDES_TX_PARRATE_REC_DETECT_IDLE_EN_ADDR A:0x60078230
y.create.l HWIO_USB3PHY_QSERDES_TX_BIST_PATTERN1_ADDR A:0x60078234
y.create.l HWIO_USB3PHY_QSERDES_TX_BIST_PATTERN2_ADDR A:0x60078238
y.create.l HWIO_USB3PHY_QSERDES_TX_BIST_PATTERN3_ADDR A:0x6007823c
y.create.l HWIO_USB3PHY_QSERDES_TX_BIST_PATTERN4_ADDR A:0x60078240
y.create.l HWIO_USB3PHY_QSERDES_TX_BIST_PATTERN5_ADDR A:0x60078244
y.create.l HWIO_USB3PHY_QSERDES_TX_BIST_PATTERN6_ADDR A:0x60078248
y.create.l HWIO_USB3PHY_QSERDES_TX_BIST_PATTERN7_ADDR A:0x6007824c
y.create.l HWIO_USB3PHY_QSERDES_TX_BIST_PATTERN8_ADDR A:0x60078250
y.create.l HWIO_USB3PHY_QSERDES_TX_LANE_MODE_ADDR A:0x60078254
y.create.l HWIO_USB3PHY_QSERDES_TX_IDAC_CAL_LANE_MODE_ADDR A:0x60078258
y.create.l HWIO_USB3PHY_QSERDES_TX_IDAC_CAL_LANE_MODE_CONFIGURATION_ADDR A:0x6007825c
y.create.l HWIO_USB3PHY_QSERDES_TX_ATB_SEL1_ADDR A:0x60078260
y.create.l HWIO_USB3PHY_QSERDES_TX_ATB_SEL2_ADDR A:0x60078264
y.create.l HWIO_USB3PHY_QSERDES_TX_RCV_DETECT_LVL_ADDR A:0x60078268
y.create.l HWIO_USB3PHY_QSERDES_TX_PRBS_SEED1_ADDR A:0x6007826c
y.create.l HWIO_USB3PHY_QSERDES_TX_PRBS_SEED2_ADDR A:0x60078270
y.create.l HWIO_USB3PHY_QSERDES_TX_PRBS_SEED3_ADDR A:0x60078274
y.create.l HWIO_USB3PHY_QSERDES_TX_PRBS_SEED4_ADDR A:0x60078278
y.create.l HWIO_USB3PHY_QSERDES_TX_RESET_GEN_ADDR A:0x6007827c
y.create.l HWIO_USB3PHY_QSERDES_TX_TRAN_DRVR_EMP_EN_ADDR A:0x60078280
y.create.l HWIO_USB3PHY_QSERDES_TX_TX_INTERFACE_MODE_ADDR A:0x60078284
y.create.l HWIO_USB3PHY_QSERDES_TX_PWM_CTRL_ADDR A:0x60078288
y.create.l HWIO_USB3PHY_QSERDES_TX_PWM_DATA_ADDR A:0x6007828c
y.create.l HWIO_USB3PHY_QSERDES_TX_PWM_ENC_DIV_CTRL_ADDR A:0x60078290
y.create.l HWIO_USB3PHY_QSERDES_TX_VMODE_CTRL1_ADDR A:0x60078294
y.create.l HWIO_USB3PHY_QSERDES_TX_VMODE_CTRL2_ADDR A:0x60078298
y.create.l HWIO_USB3PHY_QSERDES_TX_VMODE_CTRL3_ADDR A:0x6007829c
y.create.l HWIO_USB3PHY_QSERDES_TX_VMODE_CTRL4_ADDR A:0x600782a0
y.create.l HWIO_USB3PHY_QSERDES_TX_VMODE_CTRL5_ADDR A:0x600782a4
y.create.l HWIO_USB3PHY_QSERDES_TX_VMODE_CTRL6_ADDR A:0x600782a8
y.create.l HWIO_USB3PHY_QSERDES_TX_VMODE_CTRL7_ADDR A:0x600782ac
y.create.l HWIO_USB3PHY_QSERDES_TX_TX_ALOG_INTF_OBSV_CNTL_ADDR A:0x600782b0
y.create.l HWIO_USB3PHY_QSERDES_TX_BIST_STATUS_ADDR A:0x600782b4
y.create.l HWIO_USB3PHY_QSERDES_TX_BIST_ERROR_COUNT1_ADDR A:0x600782b8
y.create.l HWIO_USB3PHY_QSERDES_TX_BIST_ERROR_COUNT2_ADDR A:0x600782bc
y.create.l HWIO_USB3PHY_QSERDES_TX_TX_ALOG_INTF_OBSV_ADDR A:0x600782c0
y.create.l HWIO_USB3PHY_QSERDES_TX_PWM_DEC_STATUS_ADDR A:0x600782c4
y.create.l HWIO_USB3PHY_QSERDES_RX_CDR_CONTROL1_ADDR A:0x60078400
y.create.l HWIO_USB3PHY_QSERDES_RX_CDR_CONTROL2_ADDR A:0x60078404
y.create.l HWIO_USB3PHY_QSERDES_RX_CDR_CONTROL_HALF_ADDR A:0x60078408
y.create.l HWIO_USB3PHY_QSERDES_RX_CDR_CONTROL_QUARTER_ADDR A:0x6007840c
y.create.l HWIO_USB3PHY_QSERDES_RX_CDR_CONTROL_EIGHTH_ADDR A:0x60078410
y.create.l HWIO_USB3PHY_QSERDES_RX_UCDR_FO_GAIN_ADDR A:0x60078414
y.create.l HWIO_USB3PHY_QSERDES_RX_UCDR_SO_GAIN_ADDR A:0x60078418
y.create.l HWIO_USB3PHY_QSERDES_RX_UCDR_SO_SATURATION_AND_ENABLE_ADDR A:0x6007841c
y.create.l HWIO_USB3PHY_QSERDES_RX_UCDR_FO_TO_SO_DELAY_ADDR A:0x60078420
y.create.l HWIO_USB3PHY_QSERDES_RX_AUX_CONTROL_ADDR A:0x60078424
y.create.l HWIO_USB3PHY_QSERDES_RX_AUX_DATA_TCOARSE_ADDR A:0x60078428
y.create.l HWIO_USB3PHY_QSERDES_RX_AUX_DATA_TFINE_LSB_ADDR A:0x6007842c
y.create.l HWIO_USB3PHY_QSERDES_RX_AUX_DATA_TFINE_MSB_ADDR A:0x60078430
y.create.l HWIO_USB3PHY_QSERDES_RX_RCLK_AUXDATA_SEL_ADDR A:0x60078434
y.create.l HWIO_USB3PHY_QSERDES_RX_AC_JTAG_ENABLE_ADDR A:0x60078438
y.create.l HWIO_USB3PHY_QSERDES_RX_AC_JTAG_INITP_ADDR A:0x6007843c
y.create.l HWIO_USB3PHY_QSERDES_RX_AC_JTAG_INITN_ADDR A:0x60078440
y.create.l HWIO_USB3PHY_QSERDES_RX_AC_JTAG_LVL_ADDR A:0x60078444
y.create.l HWIO_USB3PHY_QSERDES_RX_AC_JTAG_MODE_ADDR A:0x60078448
y.create.l HWIO_USB3PHY_QSERDES_RX_AC_JTAG_RESET_ADDR A:0x6007844c
y.create.l HWIO_USB3PHY_QSERDES_RX_RX_RCVR_IQ_EN_ADDR A:0x60078450
y.create.l HWIO_USB3PHY_QSERDES_RX_RX_IDAC_I_DC_OFFSETS_ADDR A:0x60078454
y.create.l HWIO_USB3PHY_QSERDES_RX_RX_IDAC_Q_DC_OFFSETS_ADDR A:0x60078458
y.create.l HWIO_USB3PHY_QSERDES_RX_RX_IDAC_A_DC_OFFSETS_ADDR A:0x6007845c
y.create.l HWIO_USB3PHY_QSERDES_RX_RX_IDAC_EN_ADDR A:0x60078460
y.create.l HWIO_USB3PHY_QSERDES_RX_RX_IDAC_CTRL0_ADDR A:0x60078464
y.create.l HWIO_USB3PHY_QSERDES_RX_RX_IDAC_CTRL1_ADDR A:0x60078468
y.create.l HWIO_USB3PHY_QSERDES_RX_RX_EOM_EN_ADDR A:0x6007846c
y.create.l HWIO_USB3PHY_QSERDES_RX_RX_EOM_CTRL0_ADDR A:0x60078470
y.create.l HWIO_USB3PHY_QSERDES_RX_RX_EOM_CTRL1_ADDR A:0x60078474
y.create.l HWIO_USB3PHY_QSERDES_RX_RX_EOM_CTRL2_ADDR A:0x60078478
y.create.l HWIO_USB3PHY_QSERDES_RX_RX_EOM_CTRL3_ADDR A:0x6007847c
y.create.l HWIO_USB3PHY_QSERDES_RX_RX_EOM_CTRL4_ADDR A:0x60078480
y.create.l HWIO_USB3PHY_QSERDES_RX_RX_EOM_CTRL5_ADDR A:0x60078484
y.create.l HWIO_USB3PHY_QSERDES_RX_RX_EOM_CTRL6_ADDR A:0x60078488
y.create.l HWIO_USB3PHY_QSERDES_RX_RX_EOM_CTRL7_ADDR A:0x6007848c
y.create.l HWIO_USB3PHY_QSERDES_RX_RX_EOM_CTRL8_ADDR A:0x60078490
y.create.l HWIO_USB3PHY_QSERDES_RX_RX_EOM_CTRL9_ADDR A:0x60078494
y.create.l HWIO_USB3PHY_QSERDES_RX_RX_EOM_CTRL10_ADDR A:0x60078498
y.create.l HWIO_USB3PHY_QSERDES_RX_RX_EOM_CTRL11_ADDR A:0x6007849c
y.create.l HWIO_USB3PHY_QSERDES_RX_RX_HIGHZ_HIGHRATE_ADDR A:0x600784a0
y.create.l HWIO_USB3PHY_QSERDES_RX_RX_TERM_AC_BYPASS_DC_COUPLE_OFFSET_ADDR A:0x600784a4
y.create.l HWIO_USB3PHY_QSERDES_RX_RX_EQ_GAIN1_LSB_ADDR A:0x600784a8
y.create.l HWIO_USB3PHY_QSERDES_RX_RX_EQ_GAIN1_MSB_ADDR A:0x600784ac
y.create.l HWIO_USB3PHY_QSERDES_RX_RX_EQ_GAIN2_LSB_ADDR A:0x600784b0
y.create.l HWIO_USB3PHY_QSERDES_RX_RX_EQ_GAIN2_MSB_ADDR A:0x600784b4
y.create.l HWIO_USB3PHY_QSERDES_RX_RX_EQU_ADAPTOR_CNTRL1_ADDR A:0x600784b8
y.create.l HWIO_USB3PHY_QSERDES_RX_RX_EQU_ADAPTOR_CNTRL2_ADDR A:0x600784bc
y.create.l HWIO_USB3PHY_QSERDES_RX_RX_EQU_ADAPTOR_CNTRL3_ADDR A:0x600784c0
y.create.l HWIO_USB3PHY_QSERDES_RX_RX_EQU_ADAPTOR_CNTRL4_ADDR A:0x600784c4
y.create.l HWIO_USB3PHY_QSERDES_RX_RX_IDAC_CAL_CONFIGURATION_ADDR A:0x600784c8
y.create.l HWIO_USB3PHY_QSERDES_RX_RX_IDAC_CAL_CONFIGURATION_2_ADDR A:0x600784cc
y.create.l HWIO_USB3PHY_QSERDES_RX_RX_IDAC_TSETTLE_LOW_ADDR A:0x600784d0
y.create.l HWIO_USB3PHY_QSERDES_RX_RX_IDAC_TSETTLE_HIGH_ADDR A:0x600784d4
y.create.l HWIO_USB3PHY_QSERDES_RX_RX_IDAC_ENDSAMP_LOW_ADDR A:0x600784d8
y.create.l HWIO_USB3PHY_QSERDES_RX_RX_IDAC_ENDSAMP_HIGH_ADDR A:0x600784dc
y.create.l HWIO_USB3PHY_QSERDES_RX_RX_IDAC_MIDPOINT_LOW_ADDR A:0x600784e0
y.create.l HWIO_USB3PHY_QSERDES_RX_RX_IDAC_MIDPOINT_HIGH_ADDR A:0x600784e4
y.create.l HWIO_USB3PHY_QSERDES_RX_RX_EQ_OFFSET_LSB_ADDR A:0x600784e8
y.create.l HWIO_USB3PHY_QSERDES_RX_RX_EQ_OFFSET_MSB_ADDR A:0x600784ec
y.create.l HWIO_USB3PHY_QSERDES_RX_RX_EQ_OFFSET_ADAPTOR_CNTRL1_ADDR A:0x600784f0
y.create.l HWIO_USB3PHY_QSERDES_RX_RX_OFFSET_ADAPTOR_CNTRL2_ADDR A:0x600784f4
y.create.l HWIO_USB3PHY_QSERDES_RX_SIGDET_ENABLES_ADDR A:0x600784f8
y.create.l HWIO_USB3PHY_QSERDES_RX_SIGDET_ENABLES_2_ADDR A:0x600784fc
y.create.l HWIO_USB3PHY_QSERDES_RX_SIGDET_CNTRL_ADDR A:0x60078500
y.create.l HWIO_USB3PHY_QSERDES_RX_SIGDET_DEGLITCH_CNTRL_ADDR A:0x60078504
y.create.l HWIO_USB3PHY_QSERDES_RX_SIGDET_TIMER_LIMIT_ADDR A:0x60078508
y.create.l HWIO_USB3PHY_QSERDES_RX_RX_BAND_ADDR A:0x6007850c
y.create.l HWIO_USB3PHY_QSERDES_RX_CDR_FREEZE_UP_DN_ADDR A:0x60078510
y.create.l HWIO_USB3PHY_QSERDES_RX_RX_INTERFACE_MODE_ADDR A:0x60078514
y.create.l HWIO_USB3PHY_QSERDES_RX_JITTER_GEN_MODE_ADDR A:0x60078518
y.create.l HWIO_USB3PHY_QSERDES_RX_BUJ_AMP_ADDR A:0x6007851c
y.create.l HWIO_USB3PHY_QSERDES_RX_SJ_AMP1_ADDR A:0x60078520
y.create.l HWIO_USB3PHY_QSERDES_RX_SJ_AMP2_ADDR A:0x60078524
y.create.l HWIO_USB3PHY_QSERDES_RX_SJ_PER1_ADDR A:0x60078528
y.create.l HWIO_USB3PHY_QSERDES_RX_SJ_PER2_ADDR A:0x6007852c
y.create.l HWIO_USB3PHY_QSERDES_RX_BUJ_STEP_FREQ1_ADDR A:0x60078530
y.create.l HWIO_USB3PHY_QSERDES_RX_BUJ_STEP_FREQ2_ADDR A:0x60078534
y.create.l HWIO_USB3PHY_QSERDES_RX_PPM_OFFSET1_ADDR A:0x60078538
y.create.l HWIO_USB3PHY_QSERDES_RX_PPM_OFFSET2_ADDR A:0x6007853c
y.create.l HWIO_USB3PHY_QSERDES_RX_SIGN_PPM_PERIOD1_ADDR A:0x60078540
y.create.l HWIO_USB3PHY_QSERDES_RX_SIGN_PPM_PERIOD2_ADDR A:0x60078544
y.create.l HWIO_USB3PHY_QSERDES_RX_SSC_CTRL_ADDR A:0x60078548
y.create.l HWIO_USB3PHY_QSERDES_RX_SSC_COUNT1_ADDR A:0x6007854c
y.create.l HWIO_USB3PHY_QSERDES_RX_SSC_COUNT2_ADDR A:0x60078550
y.create.l HWIO_USB3PHY_QSERDES_RX_RX_ALOG_INTF_OBSV_CNTL_ADDR A:0x60078554
y.create.l HWIO_USB3PHY_QSERDES_RX_PI_CTRL1_ADDR A:0x60078558
y.create.l HWIO_USB3PHY_QSERDES_RX_PI_CTRL2_ADDR A:0x6007855c
y.create.l HWIO_USB3PHY_QSERDES_RX_PI_QUAD_ADDR A:0x60078560
y.create.l HWIO_USB3PHY_QSERDES_RX_IDATA1_ADDR A:0x60078564
y.create.l HWIO_USB3PHY_QSERDES_RX_IDATA2_ADDR A:0x60078568
y.create.l HWIO_USB3PHY_QSERDES_RX_AUX_DATA1_ADDR A:0x6007856c
y.create.l HWIO_USB3PHY_QSERDES_RX_AUX_DATA2_ADDR A:0x60078570
y.create.l HWIO_USB3PHY_QSERDES_RX_AC_JTAG_OUTP_ADDR A:0x60078574
y.create.l HWIO_USB3PHY_QSERDES_RX_AC_JTAG_OUTN_ADDR A:0x60078578
y.create.l HWIO_USB3PHY_QSERDES_RX_RX_SIGDET_ADDR A:0x6007857c
y.create.l HWIO_USB3PHY_QSERDES_RX_RX_VDCOFF_ADDR A:0x60078580
y.create.l HWIO_USB3PHY_QSERDES_RX_IDAC_CAL_ON_ADDR A:0x60078584
y.create.l HWIO_USB3PHY_QSERDES_RX_IDAC_STATUS_I_ADDR A:0x60078588
y.create.l HWIO_USB3PHY_QSERDES_RX_IDAC_STATUS_Q_ADDR A:0x6007858c
y.create.l HWIO_USB3PHY_QSERDES_RX_IDAC_STATUS_A_ADDR A:0x60078590
y.create.l HWIO_USB3PHY_QSERDES_RX_CALST_STATUS_I_ADDR A:0x60078594
y.create.l HWIO_USB3PHY_QSERDES_RX_CALST_STATUS_Q_ADDR A:0x60078598
y.create.l HWIO_USB3PHY_QSERDES_RX_CALST_STATUS_A_ADDR A:0x6007859c
y.create.l HWIO_USB3PHY_QSERDES_RX_EOM_STATUS0_ADDR A:0x600785a0
y.create.l HWIO_USB3PHY_QSERDES_RX_EOM_STATUS1_ADDR A:0x600785a4
y.create.l HWIO_USB3PHY_QSERDES_RX_EOM_STATUS2_ADDR A:0x600785a8
y.create.l HWIO_USB3PHY_QSERDES_RX_EOM_STATUS3_ADDR A:0x600785ac
y.create.l HWIO_USB3PHY_QSERDES_RX_EOM_STATUS4_ADDR A:0x600785b0
y.create.l HWIO_USB3PHY_QSERDES_RX_EOM_STATUS5_ADDR A:0x600785b4
y.create.l HWIO_USB3PHY_QSERDES_RX_EOM_STATUS6_ADDR A:0x600785b8
y.create.l HWIO_USB3PHY_QSERDES_RX_EOM_STATUS7_ADDR A:0x600785bc
y.create.l HWIO_USB3PHY_QSERDES_RX_EOM_STATUS8_ADDR A:0x600785c0
y.create.l HWIO_USB3PHY_QSERDES_RX_EOM_STATUS9_ADDR A:0x600785c4
y.create.l HWIO_USB3PHY_QSERDES_RX_RX_ALOG_INTF_OBSV_ADDR A:0x600785c8
y.create.l HWIO_USB3PHY_QSERDES_RX_READ_EQCODE_ADDR A:0x600785cc
y.create.l HWIO_USB3PHY_QSERDES_RX_READ_OFFSETCODE_ADDR A:0x600785d0
y.create.l HWIO_USB3PHY_PCIE_USB3_PHY_SW_RESET_ADDR A:0x60078600
y.create.l HWIO_USB3PHY_PCIE_USB3_PHY_POWER_DOWN_CONTROL_ADDR A:0x60078604
y.create.l HWIO_USB3PHY_PCIE_USB3_PHY_START_ADDR A:0x60078608
y.create.l HWIO_USB3PHY_PCIE_USB3_PHY_TXMGN_V1_V0_ADDR A:0x6007860c
y.create.l HWIO_USB3PHY_PCIE_USB3_PHY_TXMGN_V3_V2_ADDR A:0x60078610
y.create.l HWIO_USB3PHY_PCIE_USB3_PHY_TXMGN_LS_V4_ADDR A:0x60078614
y.create.l HWIO_USB3PHY_PCIE_USB3_PHY_TXDEEMPH_M6DB_V0_ADDR A:0x60078618
y.create.l HWIO_USB3PHY_PCIE_USB3_PHY_TXDEEMPH_M3P5DB_V0_ADDR A:0x6007861c
y.create.l HWIO_USB3PHY_PCIE_USB3_PHY_TXDEEMPH_M6DB_V1_ADDR A:0x60078620
y.create.l HWIO_USB3PHY_PCIE_USB3_PHY_TXDEEMPH_M3P5DB_V1_ADDR A:0x60078624
y.create.l HWIO_USB3PHY_PCIE_USB3_PHY_TXDEEMPH_M6DB_V2_ADDR A:0x60078628
y.create.l HWIO_USB3PHY_PCIE_USB3_PHY_TXDEEMPH_M3P5DB_V2_ADDR A:0x6007862c
y.create.l HWIO_USB3PHY_PCIE_USB3_PHY_TXDEEMPH_M6DB_V3_ADDR A:0x60078630
y.create.l HWIO_USB3PHY_PCIE_USB3_PHY_TXDEEMPH_M3P5DB_V3_ADDR A:0x60078634
y.create.l HWIO_USB3PHY_PCIE_USB3_PHY_TXDEEMPH_M6DB_V4_ADDR A:0x60078638
y.create.l HWIO_USB3PHY_PCIE_USB3_PHY_TXDEEMPH_M3P5DB_V4_ADDR A:0x6007863c
y.create.l HWIO_USB3PHY_PCIE_USB3_PHY_TXDEEMPH_M6DB_LS_ADDR A:0x60078640
y.create.l HWIO_USB3PHY_PCIE_USB3_PHY_TXDEEMPH_M3P5DB_LS_ADDR A:0x60078644
y.create.l HWIO_USB3PHY_PCIE_USB3_PHY_ENDPOINT_REFCLK_DRIVE_ADDR A:0x60078648
y.create.l HWIO_USB3PHY_PCIE_USB3_PHY_RX_IDLE_DTCT_CNTRL_ADDR A:0x6007864c
y.create.l HWIO_USB3PHY_PCIE_USB3_PHY_POWER_STATE_CONFIG1_ADDR A:0x60078650
y.create.l HWIO_USB3PHY_PCIE_USB3_PHY_POWER_STATE_CONFIG2_ADDR A:0x60078654
y.create.l HWIO_USB3PHY_PCIE_USB3_PHY_POWER_STATE_CONFIG3_ADDR A:0x60078658
y.create.l HWIO_USB3PHY_PCIE_USB3_PHY_RCVR_DTCT_DLY_P1U2_L_ADDR A:0x6007865c
y.create.l HWIO_USB3PHY_PCIE_USB3_PHY_RCVR_DTCT_DLY_P1U2_H_ADDR A:0x60078660
y.create.l HWIO_USB3PHY_PCIE_USB3_PHY_RCVR_DTCT_DLY_U3_L_ADDR A:0x60078664
y.create.l HWIO_USB3PHY_PCIE_USB3_PHY_RCVR_DTCT_DLY_U3_H_ADDR A:0x60078668
y.create.l HWIO_USB3PHY_PCIE_USB3_PHY_LOCK_DETECT_CONFIG1_ADDR A:0x6007866c
y.create.l HWIO_USB3PHY_PCIE_USB3_PHY_LOCK_DETECT_CONFIG2_ADDR A:0x60078670
y.create.l HWIO_USB3PHY_PCIE_USB3_PHY_LOCK_DETECT_CONFIG3_ADDR A:0x60078674
y.create.l HWIO_USB3PHY_PCIE_USB3_PHY_TSYNC_RSYNC_TIME_ADDR A:0x60078678
y.create.l HWIO_USB3PHY_PCIE_USB3_PHY_SIGDET_LOW_2_IDLE_TIME_ADDR A:0x6007867c
y.create.l HWIO_USB3PHY_PCIE_USB3_PHY_BEACON_2_IDLE_TIME_L_ADDR A:0x60078680
y.create.l HWIO_USB3PHY_PCIE_USB3_PHY_BEACON_2_IDLE_TIME_H_ADDR A:0x60078684
y.create.l HWIO_USB3PHY_PCIE_USB3_PHY_PWRUP_RESET_DLY_TIME_SYSCLK_ADDR A:0x60078688
y.create.l HWIO_USB3PHY_PCIE_USB3_PHY_PWRUP_RESET_DLY_TIME_AUXCLK_ADDR A:0x6007868c
y.create.l HWIO_USB3PHY_PCIE_USB3_PHY_LFPS_DET_HIGH_COUNT_VAL_ADDR A:0x60078690
y.create.l HWIO_USB3PHY_PCIE_USB3_PHY_LFPS_TX_ECSTART_EQTLOCK_ADDR A:0x60078694
y.create.l HWIO_USB3PHY_PCIE_USB3_PHY_LFPS_TX_END_CNT_P2U3_START_ADDR A:0x60078698
y.create.l HWIO_USB3PHY_PCIE_USB3_PHY_RXEQTRAINING_WAIT_TIME_ADDR A:0x6007869c
y.create.l HWIO_USB3PHY_PCIE_USB3_PHY_RXEQTRAINING_RUN_TIME_ADDR A:0x600786a0
y.create.l HWIO_USB3PHY_PCIE_USB3_PHY_TXONESZEROS_RUN_LENGTH_ADDR A:0x600786a4
y.create.l HWIO_USB3PHY_PCIE_USB3_PHY_FLL_CNTRL1_ADDR A:0x600786a8
y.create.l HWIO_USB3PHY_PCIE_USB3_PHY_FLL_CNTRL2_ADDR A:0x600786ac
y.create.l HWIO_USB3PHY_PCIE_USB3_PHY_FLL_CNT_VAL_L_ADDR A:0x600786b0
y.create.l HWIO_USB3PHY_PCIE_USB3_PHY_FLL_CNT_VAL_H_TOL_ADDR A:0x600786b4
y.create.l HWIO_USB3PHY_PCIE_USB3_PHY_FLL_MAN_CODE_ADDR A:0x600786b8
y.create.l HWIO_USB3PHY_PCIE_USB3_PHY_AUTONOMOUS_MODE_CTRL_ADDR A:0x600786bc
y.create.l HWIO_USB3PHY_PCIE_USB3_PHY_LFPS_RXTERM_IRQ_CLEAR_ADDR A:0x600786c0
y.create.l HWIO_USB3PHY_PCIE_USB3_PHY_ARCVR_DTCT_EN_PERIOD_ADDR A:0x600786c4
y.create.l HWIO_USB3PHY_PCIE_USB3_PHY_ARCVR_DTCT_CM_DLY_ADDR A:0x600786c8
y.create.l HWIO_USB3PHY_PCIE_USB3_PHY_ALFPS_DEGLITCH_VAL_ADDR A:0x600786cc
y.create.l HWIO_USB3PHY_PCIE_USB3_PHY_INSIG_SW_CTRL1_ADDR A:0x600786d0
y.create.l HWIO_USB3PHY_PCIE_USB3_PHY_INSIG_SW_CTRL2_ADDR A:0x600786d4
y.create.l HWIO_USB3PHY_PCIE_USB3_PHY_INSIG_SW_CTRL3_ADDR A:0x600786d8
y.create.l HWIO_USB3PHY_PCIE_USB3_PHY_INSIG_MX_CTRL1_ADDR A:0x600786dc
y.create.l HWIO_USB3PHY_PCIE_USB3_PHY_INSIG_MX_CTRL2_ADDR A:0x600786e0
y.create.l HWIO_USB3PHY_PCIE_USB3_PHY_INSIG_MX_CTRL3_ADDR A:0x600786e4
y.create.l HWIO_USB3PHY_PCIE_USB3_PHY_TEST_CONTROL_ADDR A:0x600786e8
y.create.l HWIO_USB3PHY_PCIE_USB3_PHY_BIST_CTRL_ADDR A:0x600786ec
y.create.l HWIO_USB3PHY_PCIE_USB3_PHY_PRBS_POLY0_ADDR A:0x600786f0
y.create.l HWIO_USB3PHY_PCIE_USB3_PHY_PRBS_POLY1_ADDR A:0x600786f4
y.create.l HWIO_USB3PHY_PCIE_USB3_PHY_PRBS_SEED0_ADDR A:0x600786f8
y.create.l HWIO_USB3PHY_PCIE_USB3_PHY_PRBS_SEED1_ADDR A:0x600786fc
y.create.l HWIO_USB3PHY_PCIE_USB3_PHY_FIXED_PAT_CTRL_ADDR A:0x60078700
y.create.l HWIO_USB3PHY_PCIE_USB3_PHY_FIXED_PAT0_ADDR A:0x60078704
y.create.l HWIO_USB3PHY_PCIE_USB3_PHY_FIXED_PAT1_ADDR A:0x60078708
y.create.l HWIO_USB3PHY_PCIE_USB3_PHY_FIXED_PAT2_ADDR A:0x6007870c
y.create.l HWIO_USB3PHY_PCIE_USB3_PHY_FIXED_PAT3_ADDR A:0x60078710
y.create.l HWIO_USB3PHY_PCIE_USB3_PHY_SPARE1_ADDR A:0x60078714
y.create.l HWIO_USB3PHY_PCIE_USB3_PHY_BIST_CHK_ERR_CNT_L_ADDR A:0x60078718
y.create.l HWIO_USB3PHY_PCIE_USB3_PHY_BIST_CHK_ERR_CNT_H_ADDR A:0x6007871c
y.create.l HWIO_USB3PHY_PCIE_USB3_PHY_BIST_CHK_STATUS_ADDR A:0x60078720
y.create.l HWIO_USB3PHY_PCIE_USB3_PHY_LFPS_RXTERM_IRQ_SOURCE_ADDR A:0x60078724
y.create.l HWIO_USB3PHY_PCIE_USB3_PHY_PCS_STATUS_ADDR A:0x60078728
y.create.l HWIO_USB3PHY_PCIE_USB3_PHY_PCS_STATUS2_ADDR A:0x6007872c
y.create.l HWIO_USB3PHY_PCIE_USB3_PHY_REVISION_ID0_ADDR A:0x60078730
y.create.l HWIO_USB3PHY_PCIE_USB3_PHY_REVISION_ID1_ADDR A:0x60078734
y.create.l HWIO_USB3PHY_PCIE_USB3_PHY_REVISION_ID2_ADDR A:0x60078738
y.create.l HWIO_USB3PHY_PCIE_USB3_PHY_REVISION_ID3_ADDR A:0x6007873c
y.create.l HWIO_USB3PHY_PCIE_USB3_PHY_DEBUG_BUS_0_STATUS_ADDR A:0x60078740
y.create.l HWIO_USB3PHY_PCIE_USB3_PHY_DEBUG_BUS_1_STATUS_ADDR A:0x60078744
y.create.l HWIO_USB3PHY_PCIE_USB3_PHY_DEBUG_BUS_2_STATUS_ADDR A:0x60078748
y.create.l HWIO_USB3PHY_PCIE_USB3_PHY_DEBUG_BUS_3_STATUS_ADDR A:0x6007874c
y.create.l HWIO_HW_VERSION_ADDR A:0x6007e000
y.create.l HWIO_HW_INFO_ADDR A:0x6007e004
y.create.l HWIO_AHB2PHY_BROADCAST_EN_CFG_LOWER_ADDR A:0x6007e008
y.create.l HWIO_AHB2PHY_BROADCAST_EN_CFG_UPPER_ADDR A:0x6007e00c
y.create.l HWIO_AHB2PHY_TOP_CFG_ADDR A:0x6007e010
y.create.l HWIO_AHB2PHY_DEBUG_BUS_CFG_ADDR A:0x6007e014
y.create.l HWIO_AHB2PHY_BROADCAST_ADDRESS_SPACE_0_ADDR A:0x6007f000
y.create.l HWIO_AHB2PHY_BROADCAST_ADDRESS_SPACE_1_ADDR A:0x6007f004
y.create.l HWIO_AHB2PHY_BROADCAST_ADDRESS_SPACE_2_ADDR A:0x6007f008
y.create.l HWIO_AHB2PHY_BROADCAST_ADDRESS_SPACE_3_ADDR A:0x6007f00c
y.create.l HWIO_AHB2PHY_BROADCAST_ADDRESS_SPACE_4_ADDR A:0x6007f010
y.create.l HWIO_AHB2PHY_BROADCAST_ADDRESS_SPACE_5_ADDR A:0x6007f014
y.create.l HWIO_AHB2PHY_BROADCAST_ADDRESS_SPACE_6_ADDR A:0x6007f018
y.create.l HWIO_AHB2PHY_BROADCAST_ADDRESS_SPACE_7_ADDR A:0x6007f01c
y.create.l HWIO_AHB2PHY_BROADCAST_ADDRESS_SPACE_8_ADDR A:0x6007f020
y.create.l HWIO_AHB2PHY_BROADCAST_ADDRESS_SPACE_9_ADDR A:0x6007f024
y.create.l HWIO_XPU_CFG_PCNOC_CFG_XPU_SCR_ADDR A:0x6002e000
y.create.l HWIO_XPU_CFG_PCNOC_CFG_XPU_SWDR_ADDR A:0x6002e004
y.create.l HWIO_XPU_CFG_PCNOC_CFG_XPU_PRTN_RACR_SSHADOW_ADDR A:0x6002e008
y.create.l HWIO_XPU_CFG_PCNOC_CFG_XPU_PRTN_WACR_SSHADOW_ADDR A:0x6002e00c
y.create.l HWIO_XPU_CFG_PCNOC_CFG_XPU_PRTN_START_SSHADOW0_ADDR A:0x6002e010
y.create.l HWIO_XPU_CFG_PCNOC_CFG_XPU_PRTN_END_SSHADOW0_ADDR A:0x6002e018
y.create.l HWIO_XPU_CFG_PCNOC_CFG_XPU_SEAR0_ADDR A:0x6002e040
y.create.l HWIO_XPU_CFG_PCNOC_CFG_XPU_SESR_ADDR A:0x6002e048
y.create.l HWIO_XPU_CFG_PCNOC_CFG_XPU_SESRRESTORE_ADDR A:0x6002e04c
y.create.l HWIO_XPU_CFG_PCNOC_CFG_XPU_SESYNR0_ADDR A:0x6002e050
y.create.l HWIO_XPU_CFG_PCNOC_CFG_XPU_SESYNR1_ADDR A:0x6002e054
y.create.l HWIO_XPU_CFG_PCNOC_CFG_XPU_SESYNR2_ADDR A:0x6002e058
y.create.l HWIO_XPU_CFG_PCNOC_CFG_XPU_MCR_ADDR A:0x6002e100
y.create.l HWIO_XPU_CFG_PCNOC_CFG_XPU_MEAR0_ADDR A:0x6002e140
y.create.l HWIO_XPU_CFG_PCNOC_CFG_XPU_MESR_ADDR A:0x6002e148
y.create.l HWIO_XPU_CFG_PCNOC_CFG_XPU_MESRRESTORE_ADDR A:0x6002e14c
y.create.l HWIO_XPU_CFG_PCNOC_CFG_XPU_MESYNR0_ADDR A:0x6002e150
y.create.l HWIO_XPU_CFG_PCNOC_CFG_XPU_MESYNR1_ADDR A:0x6002e154
y.create.l HWIO_XPU_CFG_PCNOC_CFG_XPU_MESYNR2_ADDR A:0x6002e158
y.create.l HWIO_XPU_CFG_PCNOC_CFG_XPU_CR_ADDR A:0x6002e080
y.create.l HWIO_XPU_CFG_PCNOC_CFG_XPU_PRTN_RACR_SHADOW_ADDR A:0x6002e088
y.create.l HWIO_XPU_CFG_PCNOC_CFG_XPU_PRTN_WACR_SHADOW_ADDR A:0x6002e08c
y.create.l HWIO_XPU_CFG_PCNOC_CFG_XPU_PRTN_START_SHADOW0_ADDR A:0x6002e090
y.create.l HWIO_XPU_CFG_PCNOC_CFG_XPU_PRTN_END_SHADOW0_ADDR A:0x6002e098
y.create.l HWIO_XPU_CFG_PCNOC_CFG_XPU_RPU_ACR0_ADDR A:0x6002e0a0
y.create.l HWIO_XPU_CFG_PCNOC_CFG_XPU_EAR0_ADDR A:0x6002e0c0
y.create.l HWIO_XPU_CFG_PCNOC_CFG_XPU_ESR_ADDR A:0x6002e0c8
y.create.l HWIO_XPU_CFG_PCNOC_CFG_XPU_ESRRESTORE_ADDR A:0x6002e0cc
y.create.l HWIO_XPU_CFG_PCNOC_CFG_XPU_ESYNR0_ADDR A:0x6002e0d0
y.create.l HWIO_XPU_CFG_PCNOC_CFG_XPU_ESYNR1_ADDR A:0x6002e0d4
y.create.l HWIO_XPU_CFG_PCNOC_CFG_XPU_ESYNR2_ADDR A:0x6002e0d8
y.create.l HWIO_XPU_CFG_PCNOC_CFG_XPU_UMR_RACR_ADDR A:0x6002e0e0
y.create.l HWIO_XPU_CFG_PCNOC_CFG_XPU_UMR_WACR_ADDR A:0x6002e0e4
y.create.l HWIO_XPU_CFG_PCNOC_CFG_XPU_UMR_CNTL_ADDR A:0x6002e0f0
y.create.l HWIO_XPU_CFG_PCNOC_CFG_XPU_IDR0_ADDR A:0x6002e074
y.create.l HWIO_XPU_CFG_PCNOC_CFG_XPU_IDR1_ADDR A:0x6002e078
y.create.l HWIO_XPU_CFG_PCNOC_CFG_XPU_REV_ADDR A:0x6002e07c
y.create.l HWIO_XPU_CFG_PCNOC_CFG_XPU_PRT0_RACR0_ADDR A:0x6002e200
y.create.l HWIO_XPU_CFG_PCNOC_CFG_XPU_PRT1_RACR0_ADDR A:0x6002e280
y.create.l HWIO_XPU_CFG_PCNOC_CFG_XPU_PRT2_RACR0_ADDR A:0x6002e300
y.create.l HWIO_XPU_CFG_PCNOC_CFG_XPU_PRT3_RACR0_ADDR A:0x6002e380
y.create.l HWIO_XPU_CFG_PCNOC_CFG_XPU_PRT0_WACR0_ADDR A:0x6002e220
y.create.l HWIO_XPU_CFG_PCNOC_CFG_XPU_PRT1_WACR0_ADDR A:0x6002e2a0
y.create.l HWIO_XPU_CFG_PCNOC_CFG_XPU_PRT2_WACR0_ADDR A:0x6002e320
y.create.l HWIO_XPU_CFG_PCNOC_CFG_XPU_PRT3_WACR0_ADDR A:0x6002e3a0
y.create.l HWIO_XPU_CFG_PCNOC_CFG_XPU_PRT0_START0_ADDR A:0x6002e240
y.create.l HWIO_XPU_CFG_PCNOC_CFG_XPU_PRT1_START0_ADDR A:0x6002e2c0
y.create.l HWIO_XPU_CFG_PCNOC_CFG_XPU_PRT2_START0_ADDR A:0x6002e340
y.create.l HWIO_XPU_CFG_PCNOC_CFG_XPU_PRT3_START0_ADDR A:0x6002e3c0
y.create.l HWIO_XPU_CFG_PCNOC_CFG_XPU_PRT0_END0_ADDR A:0x6002e248
y.create.l HWIO_XPU_CFG_PCNOC_CFG_XPU_PRT1_END0_ADDR A:0x6002e2c8
y.create.l HWIO_XPU_CFG_PCNOC_CFG_XPU_PRT2_END0_ADDR A:0x6002e348
y.create.l HWIO_XPU_CFG_PCNOC_CFG_XPU_PRT3_END0_ADDR A:0x6002e3c8
y.create.l HWIO_XPU_CFG_PCNOC_CFG_XPU_PRT0_SCR_ADDR A:0x6002e250
y.create.l HWIO_XPU_CFG_PCNOC_CFG_XPU_PRT1_SCR_ADDR A:0x6002e2d0
y.create.l HWIO_XPU_CFG_PCNOC_CFG_XPU_PRT2_SCR_ADDR A:0x6002e350
y.create.l HWIO_XPU_CFG_PCNOC_CFG_XPU_PRT3_SCR_ADDR A:0x6002e3d0
y.create.l HWIO_XPU_CFG_PCNOC_CFG_XPU_PRT0_MCR_ADDR A:0x6002e254
y.create.l HWIO_XPU_CFG_PCNOC_CFG_XPU_PRT1_MCR_ADDR A:0x6002e2d4
y.create.l HWIO_XPU_CFG_PCNOC_CFG_XPU_PRT2_MCR_ADDR A:0x6002e354
y.create.l HWIO_XPU_CFG_PCNOC_CFG_XPU_PRT3_MCR_ADDR A:0x6002e3d4
y.create.l HWIO_XPU_CFG_PCNOC_CFG_XPU_PRT0_CNTL0_ADDR A:0x6002e258
y.create.l HWIO_XPU_CFG_PCNOC_CFG_XPU_PRT1_CNTL0_ADDR A:0x6002e2d8
y.create.l HWIO_XPU_CFG_PCNOC_CFG_XPU_PRT2_CNTL0_ADDR A:0x6002e358
y.create.l HWIO_XPU_CFG_PCNOC_CFG_XPU_PRT3_CNTL0_ADDR A:0x6002e3d8
y.create.l HWIO_XPU_CFG_PCNOC_CFG_XPU_PRT0_CNTL1_ADDR A:0x6002e25c
y.create.l HWIO_XPU_CFG_PCNOC_CFG_XPU_PRT1_CNTL1_ADDR A:0x6002e2dc
y.create.l HWIO_XPU_CFG_PCNOC_CFG_XPU_PRT2_CNTL1_ADDR A:0x6002e35c
y.create.l HWIO_XPU_CFG_PCNOC_CFG_XPU_PRT3_CNTL1_ADDR A:0x6002e3dc
y.create.l HWIO_XPU_CFG_PRNG_CFG_XPU_SCR_ADDR A:0x6002f000
y.create.l HWIO_XPU_CFG_PRNG_CFG_XPU_SWDR_ADDR A:0x6002f004
y.create.l HWIO_XPU_CFG_PRNG_CFG_XPU_SEAR0_ADDR A:0x6002f040
y.create.l HWIO_XPU_CFG_PRNG_CFG_XPU_SESR_ADDR A:0x6002f048
y.create.l HWIO_XPU_CFG_PRNG_CFG_XPU_SESRRESTORE_ADDR A:0x6002f04c
y.create.l HWIO_XPU_CFG_PRNG_CFG_XPU_SESYNR0_ADDR A:0x6002f050
y.create.l HWIO_XPU_CFG_PRNG_CFG_XPU_SESYNR1_ADDR A:0x6002f054
y.create.l HWIO_XPU_CFG_PRNG_CFG_XPU_SESYNR2_ADDR A:0x6002f058
y.create.l HWIO_XPU_CFG_PRNG_CFG_XPU_MCR_ADDR A:0x6002f100
y.create.l HWIO_XPU_CFG_PRNG_CFG_XPU_MEAR0_ADDR A:0x6002f140
y.create.l HWIO_XPU_CFG_PRNG_CFG_XPU_MESR_ADDR A:0x6002f148
y.create.l HWIO_XPU_CFG_PRNG_CFG_XPU_MESRRESTORE_ADDR A:0x6002f14c
y.create.l HWIO_XPU_CFG_PRNG_CFG_XPU_MESYNR0_ADDR A:0x6002f150
y.create.l HWIO_XPU_CFG_PRNG_CFG_XPU_MESYNR1_ADDR A:0x6002f154
y.create.l HWIO_XPU_CFG_PRNG_CFG_XPU_MESYNR2_ADDR A:0x6002f158
y.create.l HWIO_XPU_CFG_PRNG_CFG_XPU_CR_ADDR A:0x6002f080
y.create.l HWIO_XPU_CFG_PRNG_CFG_XPU_RPU_ACR0_ADDR A:0x6002f0a0
y.create.l HWIO_XPU_CFG_PRNG_CFG_XPU_EAR0_ADDR A:0x6002f0c0
y.create.l HWIO_XPU_CFG_PRNG_CFG_XPU_ESR_ADDR A:0x6002f0c8
y.create.l HWIO_XPU_CFG_PRNG_CFG_XPU_ESRRESTORE_ADDR A:0x6002f0cc
y.create.l HWIO_XPU_CFG_PRNG_CFG_XPU_ESYNR0_ADDR A:0x6002f0d0
y.create.l HWIO_XPU_CFG_PRNG_CFG_XPU_ESYNR1_ADDR A:0x6002f0d4
y.create.l HWIO_XPU_CFG_PRNG_CFG_XPU_ESYNR2_ADDR A:0x6002f0d8
y.create.l HWIO_XPU_CFG_PRNG_CFG_XPU_IDR0_ADDR A:0x6002f074
y.create.l HWIO_XPU_CFG_PRNG_CFG_XPU_IDR1_ADDR A:0x6002f078
y.create.l HWIO_XPU_CFG_PRNG_CFG_XPU_REV_ADDR A:0x6002f07c
y.create.l HWIO_XPU_CFG_PRNG_CFG_XPU_RG0_RACR0_ADDR A:0x6002f200
y.create.l HWIO_XPU_CFG_PRNG_CFG_XPU_RG0_WACR0_ADDR A:0x6002f220
y.create.l HWIO_XPU_CFG_PRNG_CFG_XPU_RG0_SCR_ADDR A:0x6002f250
y.create.l HWIO_XPU_CFG_PRNG_CFG_XPU_RG0_MCR_ADDR A:0x6002f254
y.create.l HWIO_XPU_CFG_RPM_CFG_XPU_SCR_ADDR A:0x60033000
y.create.l HWIO_XPU_CFG_RPM_CFG_XPU_SWDR_ADDR A:0x60033004
y.create.l HWIO_XPU_CFG_RPM_CFG_XPU_PRTN_RACR_SSHADOW_ADDR A:0x60033008
y.create.l HWIO_XPU_CFG_RPM_CFG_XPU_PRTN_WACR_SSHADOW_ADDR A:0x6003300c
y.create.l HWIO_XPU_CFG_RPM_CFG_XPU_PRTN_START_SSHADOW0_ADDR A:0x60033010
y.create.l HWIO_XPU_CFG_RPM_CFG_XPU_PRTN_END_SSHADOW0_ADDR A:0x60033018
y.create.l HWIO_XPU_CFG_RPM_CFG_XPU_SEAR0_ADDR A:0x60033040
y.create.l HWIO_XPU_CFG_RPM_CFG_XPU_SESR_ADDR A:0x60033048
y.create.l HWIO_XPU_CFG_RPM_CFG_XPU_SESRRESTORE_ADDR A:0x6003304c
y.create.l HWIO_XPU_CFG_RPM_CFG_XPU_SESYNR0_ADDR A:0x60033050
y.create.l HWIO_XPU_CFG_RPM_CFG_XPU_SESYNR1_ADDR A:0x60033054
y.create.l HWIO_XPU_CFG_RPM_CFG_XPU_SESYNR2_ADDR A:0x60033058
y.create.l HWIO_XPU_CFG_RPM_CFG_XPU_MCR_ADDR A:0x60033100
y.create.l HWIO_XPU_CFG_RPM_CFG_XPU_MEAR0_ADDR A:0x60033140
y.create.l HWIO_XPU_CFG_RPM_CFG_XPU_MESR_ADDR A:0x60033148
y.create.l HWIO_XPU_CFG_RPM_CFG_XPU_MESRRESTORE_ADDR A:0x6003314c
y.create.l HWIO_XPU_CFG_RPM_CFG_XPU_MESYNR0_ADDR A:0x60033150
y.create.l HWIO_XPU_CFG_RPM_CFG_XPU_MESYNR1_ADDR A:0x60033154
y.create.l HWIO_XPU_CFG_RPM_CFG_XPU_MESYNR2_ADDR A:0x60033158
y.create.l HWIO_XPU_CFG_RPM_CFG_XPU_CR_ADDR A:0x60033080
y.create.l HWIO_XPU_CFG_RPM_CFG_XPU_PRTN_RACR_SHADOW_ADDR A:0x60033088
y.create.l HWIO_XPU_CFG_RPM_CFG_XPU_PRTN_WACR_SHADOW_ADDR A:0x6003308c
y.create.l HWIO_XPU_CFG_RPM_CFG_XPU_PRTN_START_SHADOW0_ADDR A:0x60033090
y.create.l HWIO_XPU_CFG_RPM_CFG_XPU_PRTN_END_SHADOW0_ADDR A:0x60033098
y.create.l HWIO_XPU_CFG_RPM_CFG_XPU_RPU_ACR0_ADDR A:0x600330a0
y.create.l HWIO_XPU_CFG_RPM_CFG_XPU_EAR0_ADDR A:0x600330c0
y.create.l HWIO_XPU_CFG_RPM_CFG_XPU_ESR_ADDR A:0x600330c8
y.create.l HWIO_XPU_CFG_RPM_CFG_XPU_ESRRESTORE_ADDR A:0x600330cc
y.create.l HWIO_XPU_CFG_RPM_CFG_XPU_ESYNR0_ADDR A:0x600330d0
y.create.l HWIO_XPU_CFG_RPM_CFG_XPU_ESYNR1_ADDR A:0x600330d4
y.create.l HWIO_XPU_CFG_RPM_CFG_XPU_ESYNR2_ADDR A:0x600330d8
y.create.l HWIO_XPU_CFG_RPM_CFG_XPU_UMR_RACR_ADDR A:0x600330e0
y.create.l HWIO_XPU_CFG_RPM_CFG_XPU_UMR_WACR_ADDR A:0x600330e4
y.create.l HWIO_XPU_CFG_RPM_CFG_XPU_UMR_CNTL_ADDR A:0x600330f0
y.create.l HWIO_XPU_CFG_RPM_CFG_XPU_IDR0_ADDR A:0x60033074
y.create.l HWIO_XPU_CFG_RPM_CFG_XPU_IDR1_ADDR A:0x60033078
y.create.l HWIO_XPU_CFG_RPM_CFG_XPU_REV_ADDR A:0x6003307c
y.create.l HWIO_XPU_CFG_RPM_CFG_XPU_PRT0_RACR0_ADDR A:0x60033200
y.create.l HWIO_XPU_CFG_RPM_CFG_XPU_PRT1_RACR0_ADDR A:0x60033280
y.create.l HWIO_XPU_CFG_RPM_CFG_XPU_PRT0_WACR0_ADDR A:0x60033220
y.create.l HWIO_XPU_CFG_RPM_CFG_XPU_PRT1_WACR0_ADDR A:0x600332a0
y.create.l HWIO_XPU_CFG_RPM_CFG_XPU_PRT0_START0_ADDR A:0x60033240
y.create.l HWIO_XPU_CFG_RPM_CFG_XPU_PRT1_START0_ADDR A:0x600332c0
y.create.l HWIO_XPU_CFG_RPM_CFG_XPU_PRT0_END0_ADDR A:0x60033248
y.create.l HWIO_XPU_CFG_RPM_CFG_XPU_PRT1_END0_ADDR A:0x600332c8
y.create.l HWIO_XPU_CFG_RPM_CFG_XPU_PRT0_SCR_ADDR A:0x60033250
y.create.l HWIO_XPU_CFG_RPM_CFG_XPU_PRT1_SCR_ADDR A:0x600332d0
y.create.l HWIO_XPU_CFG_RPM_CFG_XPU_PRT0_MCR_ADDR A:0x60033254
y.create.l HWIO_XPU_CFG_RPM_CFG_XPU_PRT1_MCR_ADDR A:0x600332d4
y.create.l HWIO_XPU_CFG_RPM_CFG_XPU_PRT0_CNTL0_ADDR A:0x60033258
y.create.l HWIO_XPU_CFG_RPM_CFG_XPU_PRT1_CNTL0_ADDR A:0x600332d8
y.create.l HWIO_XPU_CFG_RPM_CFG_XPU_PRT0_CNTL1_ADDR A:0x6003325c
y.create.l HWIO_XPU_CFG_RPM_CFG_XPU_PRT1_CNTL1_ADDR A:0x600332dc
y.create.l HWIO_XPU_CFG_SNOC_CFG_XPU_SCR_ADDR A:0x6002d000
y.create.l HWIO_XPU_CFG_SNOC_CFG_XPU_SWDR_ADDR A:0x6002d004
y.create.l HWIO_XPU_CFG_SNOC_CFG_XPU_PRTN_RACR_SSHADOW_ADDR A:0x6002d008
y.create.l HWIO_XPU_CFG_SNOC_CFG_XPU_PRTN_WACR_SSHADOW_ADDR A:0x6002d00c
y.create.l HWIO_XPU_CFG_SNOC_CFG_XPU_PRTN_START_SSHADOW0_ADDR A:0x6002d010
y.create.l HWIO_XPU_CFG_SNOC_CFG_XPU_PRTN_END_SSHADOW0_ADDR A:0x6002d018
y.create.l HWIO_XPU_CFG_SNOC_CFG_XPU_SEAR0_ADDR A:0x6002d040
y.create.l HWIO_XPU_CFG_SNOC_CFG_XPU_SESR_ADDR A:0x6002d048
y.create.l HWIO_XPU_CFG_SNOC_CFG_XPU_SESRRESTORE_ADDR A:0x6002d04c
y.create.l HWIO_XPU_CFG_SNOC_CFG_XPU_SESYNR0_ADDR A:0x6002d050
y.create.l HWIO_XPU_CFG_SNOC_CFG_XPU_SESYNR1_ADDR A:0x6002d054
y.create.l HWIO_XPU_CFG_SNOC_CFG_XPU_SESYNR2_ADDR A:0x6002d058
y.create.l HWIO_XPU_CFG_SNOC_CFG_XPU_MCR_ADDR A:0x6002d100
y.create.l HWIO_XPU_CFG_SNOC_CFG_XPU_MEAR0_ADDR A:0x6002d140
y.create.l HWIO_XPU_CFG_SNOC_CFG_XPU_MESR_ADDR A:0x6002d148
y.create.l HWIO_XPU_CFG_SNOC_CFG_XPU_MESRRESTORE_ADDR A:0x6002d14c
y.create.l HWIO_XPU_CFG_SNOC_CFG_XPU_MESYNR0_ADDR A:0x6002d150
y.create.l HWIO_XPU_CFG_SNOC_CFG_XPU_MESYNR1_ADDR A:0x6002d154
y.create.l HWIO_XPU_CFG_SNOC_CFG_XPU_MESYNR2_ADDR A:0x6002d158
y.create.l HWIO_XPU_CFG_SNOC_CFG_XPU_CR_ADDR A:0x6002d080
y.create.l HWIO_XPU_CFG_SNOC_CFG_XPU_PRTN_RACR_SHADOW_ADDR A:0x6002d088
y.create.l HWIO_XPU_CFG_SNOC_CFG_XPU_PRTN_WACR_SHADOW_ADDR A:0x6002d08c
y.create.l HWIO_XPU_CFG_SNOC_CFG_XPU_PRTN_START_SHADOW0_ADDR A:0x6002d090
y.create.l HWIO_XPU_CFG_SNOC_CFG_XPU_PRTN_END_SHADOW0_ADDR A:0x6002d098
y.create.l HWIO_XPU_CFG_SNOC_CFG_XPU_RPU_ACR0_ADDR A:0x6002d0a0
y.create.l HWIO_XPU_CFG_SNOC_CFG_XPU_EAR0_ADDR A:0x6002d0c0
y.create.l HWIO_XPU_CFG_SNOC_CFG_XPU_ESR_ADDR A:0x6002d0c8
y.create.l HWIO_XPU_CFG_SNOC_CFG_XPU_ESRRESTORE_ADDR A:0x6002d0cc
y.create.l HWIO_XPU_CFG_SNOC_CFG_XPU_ESYNR0_ADDR A:0x6002d0d0
y.create.l HWIO_XPU_CFG_SNOC_CFG_XPU_ESYNR1_ADDR A:0x6002d0d4
y.create.l HWIO_XPU_CFG_SNOC_CFG_XPU_ESYNR2_ADDR A:0x6002d0d8
y.create.l HWIO_XPU_CFG_SNOC_CFG_XPU_UMR_RACR_ADDR A:0x6002d0e0
y.create.l HWIO_XPU_CFG_SNOC_CFG_XPU_UMR_WACR_ADDR A:0x6002d0e4
y.create.l HWIO_XPU_CFG_SNOC_CFG_XPU_UMR_CNTL_ADDR A:0x6002d0f0
y.create.l HWIO_XPU_CFG_SNOC_CFG_XPU_IDR0_ADDR A:0x6002d074
y.create.l HWIO_XPU_CFG_SNOC_CFG_XPU_IDR1_ADDR A:0x6002d078
y.create.l HWIO_XPU_CFG_SNOC_CFG_XPU_REV_ADDR A:0x6002d07c
y.create.l HWIO_XPU_CFG_SNOC_CFG_XPU_PRT0_RACR0_ADDR A:0x6002d200
y.create.l HWIO_XPU_CFG_SNOC_CFG_XPU_PRT1_RACR0_ADDR A:0x6002d280
y.create.l HWIO_XPU_CFG_SNOC_CFG_XPU_PRT2_RACR0_ADDR A:0x6002d300
y.create.l HWIO_XPU_CFG_SNOC_CFG_XPU_PRT3_RACR0_ADDR A:0x6002d380
y.create.l HWIO_XPU_CFG_SNOC_CFG_XPU_PRT0_WACR0_ADDR A:0x6002d220
y.create.l HWIO_XPU_CFG_SNOC_CFG_XPU_PRT1_WACR0_ADDR A:0x6002d2a0
y.create.l HWIO_XPU_CFG_SNOC_CFG_XPU_PRT2_WACR0_ADDR A:0x6002d320
y.create.l HWIO_XPU_CFG_SNOC_CFG_XPU_PRT3_WACR0_ADDR A:0x6002d3a0
y.create.l HWIO_XPU_CFG_SNOC_CFG_XPU_PRT0_START0_ADDR A:0x6002d240
y.create.l HWIO_XPU_CFG_SNOC_CFG_XPU_PRT1_START0_ADDR A:0x6002d2c0
y.create.l HWIO_XPU_CFG_SNOC_CFG_XPU_PRT2_START0_ADDR A:0x6002d340
y.create.l HWIO_XPU_CFG_SNOC_CFG_XPU_PRT3_START0_ADDR A:0x6002d3c0
y.create.l HWIO_XPU_CFG_SNOC_CFG_XPU_PRT0_END0_ADDR A:0x6002d248
y.create.l HWIO_XPU_CFG_SNOC_CFG_XPU_PRT1_END0_ADDR A:0x6002d2c8
y.create.l HWIO_XPU_CFG_SNOC_CFG_XPU_PRT2_END0_ADDR A:0x6002d348
y.create.l HWIO_XPU_CFG_SNOC_CFG_XPU_PRT3_END0_ADDR A:0x6002d3c8
y.create.l HWIO_XPU_CFG_SNOC_CFG_XPU_PRT0_SCR_ADDR A:0x6002d250
y.create.l HWIO_XPU_CFG_SNOC_CFG_XPU_PRT1_SCR_ADDR A:0x6002d2d0
y.create.l HWIO_XPU_CFG_SNOC_CFG_XPU_PRT2_SCR_ADDR A:0x6002d350
y.create.l HWIO_XPU_CFG_SNOC_CFG_XPU_PRT3_SCR_ADDR A:0x6002d3d0
y.create.l HWIO_XPU_CFG_SNOC_CFG_XPU_PRT0_MCR_ADDR A:0x6002d254
y.create.l HWIO_XPU_CFG_SNOC_CFG_XPU_PRT1_MCR_ADDR A:0x6002d2d4
y.create.l HWIO_XPU_CFG_SNOC_CFG_XPU_PRT2_MCR_ADDR A:0x6002d354
y.create.l HWIO_XPU_CFG_SNOC_CFG_XPU_PRT3_MCR_ADDR A:0x6002d3d4
y.create.l HWIO_XPU_CFG_SNOC_CFG_XPU_PRT0_CNTL0_ADDR A:0x6002d258
y.create.l HWIO_XPU_CFG_SNOC_CFG_XPU_PRT1_CNTL0_ADDR A:0x6002d2d8
y.create.l HWIO_XPU_CFG_SNOC_CFG_XPU_PRT2_CNTL0_ADDR A:0x6002d358
y.create.l HWIO_XPU_CFG_SNOC_CFG_XPU_PRT3_CNTL0_ADDR A:0x6002d3d8
y.create.l HWIO_XPU_CFG_SNOC_CFG_XPU_PRT0_CNTL1_ADDR A:0x6002d25c
y.create.l HWIO_XPU_CFG_SNOC_CFG_XPU_PRT1_CNTL1_ADDR A:0x6002d2dc
y.create.l HWIO_XPU_CFG_SNOC_CFG_XPU_PRT2_CNTL1_ADDR A:0x6002d35c
y.create.l HWIO_XPU_CFG_SNOC_CFG_XPU_PRT3_CNTL1_ADDR A:0x6002d3dc
y.create.done
