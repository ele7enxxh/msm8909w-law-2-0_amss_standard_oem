; ============================================================================
;
;  PMICPeek.cmm
;
;  Script to peek/poke PMIC register values.
;
;  Execution:
;    PMICPeek.cmm [ address ] [ deviceid ] [ data ]
;
;  The deviceid is 0 for the first PMIC and 1 for the second. If address
;  and deviceid are provided the script will peek the given
;  address and print the result.  If "data" is also provided the data
;  will be poked to the given address.
;
;  ====================================================================
;
;  Copyright (c) 2012-2014 QUALCOMM Technologies Incorporated.  All Rights Reserved.
;  QUALCOMM Proprietary and Confidential.
;
;  ====================================================================
;
;  $Header: //components/rel/boot.bf/3.1.2.c3/boot_images/core/systemdrivers/pmic/scripts/PMICPeek.cmm#1 $
;  $DateTime: 2015/09/01 00:30:35 $
;  $Author: pwbldsvc $
;
; ============================================================================
;

ENTRY &addr &devid &data

;-----------------------------------------------------------------------------
; SPMI variables
;-----------------------------------------------------------------------------

&PMIC_ARB_CHNLn_CMD=0x2400000
&PMIC_ARB_CHNLn_STATUS=0x2400008
&PMIC_ARB_CHNLn_WDATA0=0x2400010
&PMIC_ARB_CHNLn_RDATA0=0x2400018
&PMIC_ARB_CHNLn_ADDR=0x200f800
&CHNLn_OFFSET=0x8000
&OWNERn_OFFSET=0x1000
&MAX_SPMI_CHANNELS=128.

&SPMIOwnerChannel=0  ; Apps Channel by default
&wdog_data=0x0

;-----------------------------------------------------------------------------
; SLAVE ID DETECTION
;-----------------------------------------------------------------------------

LOCAL &PM_REVID_PERIPH_TYPE_QC_PMIC
&PM_REVID_PERIPH_TYPE_QC_PMIC=0x51

LOCAL &PM_MAX_NUM_PMICS &PM_MAX_NUM_SLAVE_IDS
&PM_MAX_NUM_SLAVE_IDS=14.
&PM_MAX_NUM_PMICS=7.

VAR.NEW int[&PM_MAX_NUM_PMICS] \PmicSlaveIdArr

VAR.NEW int \i
VAR.SET \i=0
VAR.WHILE \i<&PM_MAX_NUM_PMICS
	VAR.SET \PmicSlaveIdArr[\i++]=0

LOCAL &PM_SLAVE_ID_DETECT_FLAG
&PM_SLAVE_ID_DETECT_FLAG=0

;-----------------------------------------------------------------------------
; Default bus access mode
;-----------------------------------------------------------------------------

&BusAccessMode="A"

;-----------------------------------------------------------------------------
; Check for non-interactive mode.
;-----------------------------------------------------------------------------

IF "&addr"!=""
(
  IF "&devid"==""
  (
    &devid=0
  )

  IF "&data"==""
  (
    GOSUB PMICRead &addr &devid
    ENTRY &status &data

    IF (&status==1)
    (
      PRINT "Address='0x" &addr "' Value='0x" &data
    )
    ELSE
    (
      PRINT "SPMI error"
    )
  )
  ELSE
  (
    GOSUB PMICWrite &addr &devid &data
    ENTRY &status

    IF (&status==1)
    (
      PRINT "Write successful."
    )
    ELSE
    (
      PRINT "Write failed."
    )
  )

  ENDDO
)

;-----------------------------------------------------------------------------
; Create the dialog
;-----------------------------------------------------------------------------

DIALOG
(
  HEADER "PMIC Register Peek/Poke Tool"
   
  POS 0. 0. 25. 9.5
  BOX "Configuration"
  
  POS 1. 1.5 10. 1.
  TEXT "Address:"
  POS 12. 1.5 12. 1.
  ADDR: EDIT "" ""
  
  POS 1. 3. 10. 1.
  TEXT10: TEXT "PMIC:"
  POS 12. 3. 12. 1.
  DEVID: PULLDOWN "PMIC A,PMIC B,PMIC C,PMIC D,PMIC E,PMIC F,PMIC G"
  (
  )

  POS 1. 4.5 10. 1.
  TEXT20: TEXT "Data:"
  POS 12. 4.5 12. 1.
  DATA: EDIT "" ""

  POS 1. 6. 10. 1.
  TEXT20: TEXT "Owner:"
  POS 12. 6. 12. 1.
  OWNER: PULLDOWN "APCS,RPM,TZ,MPSS,WCNSS,LPASS"
  (
  )

  POS 1. 7.5 10. 1.
  TEXT20: TEXT "Access Mode:"
  POS 12. 7.5 12. 1.
  ACCESSMODE: PULLDOWN "A,EZAHB,EZAXI,EZ"
  (
  )

  POS 1. 11.5 20. 1.
  WDOGCTL: CHECKBOX "Disable PMIC Watchdog"
  (
    GOSUB SetOwnerChannel DIALOG.STRING(OWNER)

    &BusAccessMode=DIALOG.STRING(ACCESSMODE)
    &devid=0
    &addr=0x857
    IF DIALOG.BOOLEAN(WDOGCTL)
    (
      &wdog_data=0x0
      PRINT "PMIC WDOG Disabled"
    )
    ELSE
    (
      &wdog_data=0x80
      PRINT "PMIC WDOG Enabled"
     )

    IF ("&addr"!="")&&("&wdog_data"!="")
    (
      GOSUB PMICWrite &addr &devid &wdog_data
      ENTRY &status
      IF (&status==0)
      (
        DIALOG.SET DATA "SPMI Error!"
      )
    )
  )

  ; Instructions Box
  POS 26. 0. 35. 9.5
  BOX "Instructions"
  POS 27. 1. 30. 1.
  TEXT "1. Fill in the address to peek/poke. For the"
  POS 27. 2. 30. 1.
  TEXT "   secondary slave id address use 0x1xxxx."
  POS 27. 3. 30. 1.
  TEXT "2. Set the PMIC device and optionally the"
  POS 27. 4. 30. 1.
  TEXT "   owner channel and access mode (Click"
  POS 27. 5. 30. 1.
  TEXT "   on *Help* button below for more info)"
  POS 27. 6. 30. 1.
  TEXT "3. Click 'Peek' to read from PMIC, or fill"
  POS 27. 7. 30. 1.
  TEXT "   in Data and click 'Poke' to write to PMIC"
  
  POS 5. 9.5 10. 1.5
  DEFBUTTON "Peek" 
  (
    GOSUB SetOwnerChannel DIALOG.STRING(OWNER)

    &BusAccessMode=DIALOG.STRING(ACCESSMODE)

    IF DIALOG.STRING(DEVID)=="PMIC B"
    (
      &devid=1
    )
    ELSE IF DIALOG.STRING(DEVID)=="PMIC C"
    (
      &devid=2
    )
    ELSE IF DIALOG.STRING(DEVID)=="PMIC D"
    (
      &devid=3
    )
    ELSE IF DIALOG.STRING(DEVID)=="PMIC E"
    (
      &devid=4
    )
    ELSE IF DIALOG.STRING(DEVID)=="PMIC F"
    (
      &devid=5
    )
    ELSE IF DIALOG.STRING(DEVID)=="PMIC G"
    (
      &devid=6
    )
    ELSE
    (
      &devid=0
    )

    &addr=DIALOG.STRING(ADDR)
    IF "&addr"!=""
    (
      GOSUB PMICRead &addr &devid
      ENTRY &status &data
      IF (&status==1)
      (
        DIALOG.SET DATA "&data"
      )
      ELSE
      (
        DIALOG.SET DATA "SPMI Error!"
      )
    )
  )
  POS 17.5 9.5 10. 1.5
  DEFBUTTON "Poke" 
  (
    GOSUB SetOwnerChannel DIALOG.STRING(OWNER)

    &BusAccessMode=DIALOG.STRING(ACCESSMODE)

    IF DIALOG.STRING(DEVID)=="PMIC B"
    (
      &devid=1
    )
    ELSE IF DIALOG.STRING(DEVID)=="PMIC C"
    (
      &devid=2
    )
    ELSE IF DIALOG.STRING(DEVID)=="PMIC D"
    (
      &devid=3
    )
    ELSE IF DIALOG.STRING(DEVID)=="PMIC E"
    (
      &devid=4
    )
    ELSE IF DIALOG.STRING(DEVID)=="PMIC F"
    (
      &devid=5
    )
    ELSE IF DIALOG.STRING(DEVID)=="PMIC G"
    (
      &devid=6
    )
    ELSE
    (
      &devid=0
    )
    &addr=DIALOG.STRING(ADDR)
    &data=DIALOG.STRING(DATA)
    IF ("&addr"!="")&&("&data"!="")
    (
      GOSUB PMICWrite &addr &devid &data
      ENTRY &status
      IF (&status==0)
      (
        DIALOG.SET DATA "SPMI Error!"
      )
    )
  )

  POS 30. 9.5 10. 1.5
  DEFBUTTON "Help" 
  (
    AREA.RESET 
    WINPOS 0% 50% 68% 55% 0. 0. W001
    AREA.CREATE PMIC
    AREA.VIEW PMIC
    AREA.SELECT PMIC
    PRINT "----------------------------------------------------------------------------------------------------------------------------"
    PRINT "**IF ACCESS MODE 'A' IS USED, YOU NEED TO BREAK THE T32 TO GET THE STATUS DATA**"
    PRINT "----------------------------------------------------------------------------------------------------------------------------"
    PRINT "FOR RELIABLE STATUS DATA WITHOUT BREAKING THE T32, BELOW ARE THE ACCESS MODES AND OWNER OPTIONS TO BE USED FROM APCS T32 WINDOW:"
    PRINT ""
    PRINT "MDM9x45          --> ACCESS MODE:EZAXI, OWNER:LPASS"
    PRINT "MSM8909          --> ACCESS MODE:EZAXI, OWNER:LPASS"
    PRINT "MSM8952          --> ACCESS MODE:EZAXI, OWNER:LPASS"
    PRINT "MSM8916          --> ACCESS MODE:EZ,    OWNER:LPASS"
    PRINT "NEWER TARGETS    --> ACCESS MODE:EZAXI, OWNER:LPASS"
    PRINT "----------------------------------------------------------------------------------------------------------------------------"
  )

  POS 42.5 9.5 10. 1.5
  BUTTON "Close" "JUMPTO winclose"
  CLOSE "JUMPTO winclose"
)
STOP

winclose:
DIALOG.END
ENDDO


;=============================================================================
;=============================================================================
; SUBROUTINES
;=============================================================================
;=============================================================================

;=============================================================================
; SUB: PmicSlaveIdDetection
;=============================================================================

PmicSlaveIdDetection:

  &verPeriphBaseAddr=0x100
  &verPeriphTypeAddr=&verPeriphBaseAddr+0x04
  &verPeriphTypeData=0
  &verPeriphTypeStatus=0
  &verSlaveId=0
  &verDeviceIndex=0

  WHILE (&verSlaveId<=&PM_MAX_NUM_SLAVE_IDS)
  (
    IF (&verDeviceIndex<&PM_MAX_NUM_PMICS)
    (
      GOSUB SPMIRead &verPeriphTypeAddr &verSlaveId
      ENTRY &verPeriphTypeStatus &verPeriphTypeData

      IF ((&verPeriphTypeStatus!=0)&&(&verPeriphTypeData!=0)&&(&verPeriphTypeData==&PM_REVID_PERIPH_TYPE_QC_PMIC))
      (
        VAR.SET \PmicSlaveIdArr[&verDeviceIndex]=&verSlaveId

        &verDeviceIndex=&verDeviceIndex+1
      )
    )
    &verSlaveId=&verSlaveId+2
  )

  &PM_SLAVE_ID_DETECT_FLAG=1

  RETURN

;=============================================================================
; SUB: SetOwnerChannel
;=============================================================================

SetOwnerChannel:

  ENTRY &OwnerName

  &PMIC_ARB_CHNLn_CMD=0x2400000
  &PMIC_ARB_CHNLn_STATUS=0x2400008
  &PMIC_ARB_CHNLn_WDATA0=0x2400010
  &PMIC_ARB_CHNLn_RDATA0=0x2400018
  &PMIC_ARB_CHNLn_ADDR=0x200f800

  IF &OwnerName=="APCS"
  (
    &SPMIOwnerChannel=0
  )
  ELSE IF &OwnerName=="TZ"
  (
    &SPMIOwnerChannel=1
  )
  ELSE IF &OwnerName=="MPSS"
  (
    &SPMIOwnerChannel=2
  )
  ELSE IF &OwnerName=="LPASS"
  (
    &SPMIOwnerChannel=3
  )
  ELSE IF &OwnerName=="RPM"
  (
    &SPMIOwnerChannel=4
    &PMIC_ARB_CHNLn_CMD=0x62400000
    &PMIC_ARB_CHNLn_STATUS=0x62400008
    &PMIC_ARB_CHNLn_WDATA0=0x62400010
    &PMIC_ARB_CHNLn_RDATA0=0x62400018
    &PMIC_ARB_CHNLn_ADDR=0x6200f800
  )
  ELSE IF &OwnerName=="WCNSS"
  (
    &SPMIOwnerChannel=5
  )

  RETURN


;=============================================================================
; SUB: SPMIRead
;=============================================================================

SPMIRead:

  ENTRY &RegisterAddress &SlaveId

  &RegisterOffset=(&RegisterAddress)&0xFF
  &RegisterBase=((&RegisterAddress)&0xFF00)|(&SlaveId<<0x10)
  &SPMIChannelIndex=0
  &SPMIChannel=0
  &SPMIChannelFound=0
  &breakFlag=0

  IF (STATE.RUN()&&(SYSTEM.MODE()>0x5)&&("&BusAccessMode"=="A"))
  (
    &breakFlag=1
    b
    WAIT 1.ms
  )
    
  REPEAT
  (
    IF (DATA.LONG(&BusAccessMode:(&PMIC_ARB_CHNLn_ADDR+(4*&SPMIChannelIndex)))==&RegisterBase)
    (
      &SPMIChannel=&SPMIChannelIndex
      &SPMIChannelFound=1
      &SPMIChannelIndex=&MAX_SPMI_CHANNELS
    )
    &SPMIChannelIndex=&SPMIChannelIndex+1
  )
  WHILE (&SPMIChannelIndex<=&MAX_SPMI_CHANNELS)

  &status=0
  &data=0
  IF (&SPMIChannelFound==0)
  (
    IF (&breakFlag==1)
    (
      g
    )
    RETURN &status &data
  )

  &cmd=(0x1<<0x1B)|(&RegisterOffset<<0x4)

  DATA.SET &BusAccessMode:&PMIC_ARB_CHNLn_CMD+&OWNERn_OFFSET*&SPMIOwnerChannel+&CHNLn_OFFSET*&SPMIChannel %LONG &cmd

  WHILE (&status==0)
  (
    WAIT 1.ms
    &status=DATA.LONG(&BusAccessMode:&PMIC_ARB_CHNLn_STATUS+&OWNERn_OFFSET*&SPMIOwnerChannel+&CHNLn_OFFSET*&SPMIChannel)
  )

  &data=DATA.LONG(&BusAccessMode:&PMIC_ARB_CHNLn_RDATA0+&OWNERn_OFFSET*&SPMIOwnerChannel+&CHNLn_OFFSET*&SPMIChannel)

  IF (&breakFlag==1)
  (
    g
  )

  RETURN &status &data


;=============================================================================
; SUB: SPMIWrite
;=============================================================================

SPMIWrite:

  ENTRY &RegisterAddress &SlaveId &Data

  &RegisterOffset=(&RegisterAddress)&0xFF
  &RegisterBase=((&RegisterAddress)&0xFF00)|(&SlaveId<<0x10)
  &SPMIChannelIndex=0
  &SPMIChannel=0
  &SPMIChannelFound=0
  &breakFlag=0

  IF (STATE.RUN()&&(SYSTEM.MODE()>0x5)&&("&BusAccessMode"=="A"))
  (
    &breakFlag=1
    b
    WAIT 1.ms
  )
    
  REPEAT
  (
    IF (DATA.LONG(&BusAccessMode:(&PMIC_ARB_CHNLn_ADDR+(4*&SPMIChannelIndex)))==&RegisterBase)
    (
      &SPMIChannel=&SPMIChannelIndex
      &SPMIChannelFound=1
      &SPMIChannelIndex=&MAX_SPMI_CHANNELS
    )
    &SPMIChannelIndex=&SPMIChannelIndex+1
  )
  WHILE (&SPMIChannelIndex<=&MAX_SPMI_CHANNELS)

  &status=0
  IF (&SPMIChannelFound==0)
  (
    IF (&breakFlag==1)
    (
      g
    )
    RETURN &status
  )

  DATA.SET &BusAccessMode:&PMIC_ARB_CHNLn_WDATA0+&OWNERn_OFFSET*&SPMIOwnerChannel+&CHNLn_OFFSET*&SPMIChannel %LONG (&Data&0xFF)

  &cmd=(0x0<<0x1B)|(&RegisterOffset<<0x4)

  DATA.SET &BusAccessMode:&PMIC_ARB_CHNLn_CMD+&OWNERn_OFFSET*&SPMIOwnerChannel+&CHNLn_OFFSET*&SPMIChannel %LONG &cmd
  WHILE (&status==0)
  (
    WAIT 1.ms
    &status=DATA.LONG(&BusAccessMode:&PMIC_ARB_CHNLn_STATUS+&OWNERn_OFFSET*&SPMIOwnerChannel+&CHNLn_OFFSET*&SPMIChannel)
  )

  IF (&breakFlag==1)
  (
    g
  )

  RETURN &status


;=============================================================================
; SUB: PMICToSPMI
;=============================================================================

PMICToSPMI:

  ENTRY &addr &devid
  LOCAL &spmi_sid &spmi_addr

  IF (&devid==0)
  (
    &spmi_sid=0
  )
  ELSE
  (
    IF (&PM_SLAVE_ID_DETECT_FLAG==0)
    (
      GOSUB PmicSlaveIdDetection
    )

    IF (VAR.VALUE(\PmicSlaveIdArr[&devid])!=0)
    (
      &spmi_sid=VAR.VALUE(\PmicSlaveIdArr[&devid])
    )
    ELSE
    (
      &spmi_sid=2
    )
  )

  &pmic_sid=&addr>>16.
  IF &pmic_sid==1
  (
    &spmi_sid=&spmi_sid+1
  )

  &spmi_addr=&addr&0xFFFF

  RETURN &spmi_sid &spmi_addr


;=============================================================================
; SUB: PMICRead
;=============================================================================

PMICRead:

  ENTRY &addr &devid

  GOSUB PMICToSPMI &addr &devid
  ENTRY &spmi_sid &spmi_addr

  GOSUB SPMIRead &spmi_addr &spmi_sid
  ENTRY &status &data

  RETURN &status &data


;=============================================================================
; SUB: PMICWrite
;=============================================================================

PMICWrite:

  ENTRY &addr &devid &data

  GOSUB PMICToSPMI &addr &devid
  ENTRY &spmi_sid &spmi_addr

  GOSUB SPMIWrite &spmi_addr &spmi_sid &data
  ENTRY &status

  RETURN &status


