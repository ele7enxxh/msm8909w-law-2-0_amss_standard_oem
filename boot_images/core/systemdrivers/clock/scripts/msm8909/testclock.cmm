
;============================================================================
;
; *************** THIS SCRIPT WAS AUTOGENERATED - 9/19/2014 *****************
;
; TARGET
;   MSM8909
;
; SCRIPT
;   ..\..\..\SCRIPTS\MSM8909\SHARED\TESTCLOCK.CMM
;
; GENERAL DESCRIPTION
;   This script can be used to route specific clocks to the clock test output
;   on GPIO 0
;
; FUNCTIONS
;   N/A
;
; INITIALIZATION AND SEQUENCING REQUIREMENTS
;   Invoke this script, and choose the clock to test.  The script will program
;   the necessary registers accordingly.
;
;      Copyright (c) 2014 by Qualcomm Technologies, Inc.  All Rights Reserved.
;============================================================================

;-----------------------------------------------------------------------------
; Local variables
;-----------------------------------------------------------------------------

local &clk
local &choice
local &clk_name
local &clk_state
local &clk_freq
local &clk_freq_str
local &header_printed
local &choice_handled
local &old_choice
local &clk_test
local &clk_reg
local &clk_reg_str
local &clk_reg_name
local &print_if_off
local &clk_reg_val
local &clk_reg_val_str
local &clk_reg_cbcr_type
local &state_change
local &print_menu
local &input_file
local &input_line
local &input_file_prompt
local &clock_count
local &multiplier
local &tcxo_count
local &match
local &clk_access_mod
local &testclock_cmd_arg0
local &testclock_cmd_arg1
local &testclock_cmd_arg2
local &testclock_cmd_arg3
local &testclock_cmd_arg4
local &clk_cmd_rcgr_addr
local &clk_cfg_rcgr_addr
local &clk_cmd_rcgr_val
local &clk_cfg_rcgr_val
local &clk_src_name
local &clk_src_sel
local &clk_src_div
local &clk_m_addr
local &clk_n_addr
local &clk_d_addr
local &clk_m_val
local &clk_n_val
local &clk_2d_val

; Constants required for setting clock frequencies
&HAL_CLK_CMD_CFG_UPDATE_FMSK=0x1
&HAL_CLK_CFG_CGR_SRC_SEL_SHFT=0x8
&HAL_CLK_CFG_CGR_SRC_DIV_SHFT=0x0
&HAL_CLK_CFG_CGR_SRC_SEL_FMSK=0x700
&HAL_CLK_CFG_CGR_SRC_DIV_FMSK=0x1f
&HAL_CLK_CFG_CGR_MODE_FMSK=0x3000
&HAL_CLK_CFG_CFG_DUAL_EDGE_MODE_VAL=0x2
&HAL_CLK_CFG_CGR_MODE_SHFT=0xc
&HAL_CLK_M_REG_OFFSET=0x8
&HAL_CLK_N_REG_OFFSET=0xc
&HAL_CLK_D_REG_OFFSET=0x10


;-----------------------------------------------------------------------------
; Define the window
;-----------------------------------------------------------------------------
&testclock_cmd_arg0=""
&testclock_cmd_arg1=""
&testclock_cmd_arg2=""
&testclock_cmd_arg3=""
&testclock_cmd_arg4=""

ENTRY &testclock_cmd_arg0 &testclock_cmd_arg1 &testclock_cmd_arg2 &testclock_cmd_arg3 &testclock_cmd_arg4

; Create a new area window if the script was not invoked in menu mode.
if ("&testclock_cmd_arg0"!="menu")
(
  AREA.RESet
  WINPOS 0. 0. 50% 100%
  AREA.Create CLOCK 120. 1000.
  AREA.view CLOCK
)

AREA.Select CLOCK
AREA.Clear CLOCK

;-----------------------------------------------------------------------------
; Initialize autogenerated constants
;-----------------------------------------------------------------------------

goto Init_Constants
Init_Constants_Done:

;-----------------------------------------------------------------------------
; Print banner and go to main menu
;-----------------------------------------------------------------------------

print " "
print "[----------------------------------------------- MSM8909 Clock Test ----------------------------------------------]"
print " "

;-----------------------------------------------------------------------------
; Read input
;-----------------------------------------------------------------------------

ON ERROR gosub
(
  print "Error occurred processing &clk"
  return
)

&print_if_off=1
&print_menu=1

Main_Menu:
; Only print main menu when it isn't disabled
if (&print_menu!=0)
(
  print " "
  print "Version: 1.0 <2014-09-19>"
  print "Clock (? for list): "
)
else
(
  ; re-enable the main menu after this choice is handled
  &print_menu=1
)

testclock_cmd_arg0:
  if ("&testclock_cmd_arg0"!="")&&(("&testclock_cmd_arg0"!="menu"))
  (
    &choice="&testclock_cmd_arg0"
    &testclock_cmd_arg0=""
    goto Handle_Choice
  )
  else if ("&testclock_cmd_arg0"=="menu")
  (
    goto Handle_Choice
  )
testclock_cmd_arg1:
  if ("&testclock_cmd_arg1"!="")
  (
    &choice="&testclock_cmd_arg1"
    &testclock_cmd_arg1=""
    goto Handle_Choice
  )
testclock_cmd_arg2:
  if ("&testclock_cmd_arg2"!="")
  (
    &choice="&testclock_cmd_arg2"
    &testclock_cmd_arg2=""
    goto Handle_Choice
  )
testclock_cmd_arg3:
  if ("&testclock_cmd_arg3"!="")
  (
    &choice="&testclock_cmd_arg3"
    &testclock_cmd_arg3=""
    goto Handle_Choice
  )
testclock_cmd_arg4:
  if ("&testclock_cmd_arg4"!="")
  (
    &choice="&testclock_cmd_arg4"
    &testclock_cmd_arg4=""
    goto Handle_Choice
  )

Handle_Choice:

&t32_cmm_stopped=1

if ("&choice"=="")
(
  enter &choice
)
&t32_cmm_stopped=0

&header_printed=0
&choice_handled=0
&state_change=""
&input_file_prompt=1

; Exit
if "&choice"=="?"
(
  gosub Help
  &choice_handled=1
  
  ; disable the main menu when displaying the help window
  &print_menu=0
)
else if "&choice"=="x"
(
  ; Close the window if the script was not invoked in menu mode.
  if "&testclock_cmd_arg0"=="menu"
  (
    enddo (0==0)
  )
  else
  (
    WINCLEAR TOP
    enddo (0==0)
  )
)
else if ("&choice"==".")||("&choice"=="")
(
  if "&old_choice"==""
  (
    &old_choice="?"
    
    ; disable the main menu when displaying the help window
    &print_menu=0
  )
  &choice="&old_choice"
  gosub Handle_Choice
)

;-----------------------------------------------------------------------------
; Check for enabling the clock test output on GPIOs
;-----------------------------------------------------------------------------

if "&choice"=="gpio"
(
  ; Configure HS GPIO
  ; data.set a:&HWIO_TLMM_GPIO_CFG0_ADDR %LONG 0x1D0
  ; print "GPIO 0 configured and output enabled"

  ; Enable the gcc_dbg_clk on PLLTEST.
  data.set a:&HWIO_GCC_PLLTEST_PAD_CFG_ADDR %LONG 0x1200
  print "PLLTEST_PAD configured for GCC debug clock output"

  &choice_handled=1
)

if ("&choice"=="on")||("&choice"=="off")||("&choice"=="set")
(
  &state_change="&choice"
  &choice="&old_choice"
  
  ; do not prompt user for input file again for on/off choice
  if ("&choice"=="file")
  (
    &input_file_prompt=0
  )
)

;-----------------------------------------------------------------------------
; Check for file input with a list of clocks
;-----------------------------------------------------------------------------

if ("&choice"=="file")
(
  if (&input_file_prompt==1)
  (
    print "Enter input file [c:\temp\testclock.txt]: "
    enter &input_file
    if "&input_file"==""
    (
      &input_file="c:\temp\testclock.txt"
    )
  )
  print "Operating on list of clocks from &input_file"
  OPEN #1 &input_file /Read
  READ #1 %line &input_line
  WHILE !EOF()
  (
    gosub Find_Print_Clock &input_line
    
    READ #1 %line &input_line
  )
  CLOSE #1
  
  &choice_handled=1
)


;-----------------------------------------------------------------------------
; Check for dumping all or all/on clocks
;-----------------------------------------------------------------------------

if ("&choice"=="all")||("&choice"=="all_on")
(
  if ("&choice"=="all_on")
  (
    &print_if_off=0
  )
  else
  (
    &print_if_off=1
  )

  gosub Print_All

  &print_if_off=1
  &choice_handled=1
)

if (&choice_handled!=1)
(
  gosub Print_All_SS
)

;-----------------------------------------------------------------------------
; If nothing else, then assume it was a clock name
;-----------------------------------------------------------------------------

if (&choice_handled!=1)
(
  gosub Find_Print_Clock &choice
)

&old_choice="&choice"
&choice=""
goto Main_Menu


;-----------------------------------------------------------------------------
; Display header
;-----------------------------------------------------------------------------

Print_Header:

  if &header_printed==0
  (
    print ""
    print "Clock                                      State      Frequency (MHz)         CBCR Addr : Value        CBCR Type "
    print "---------------------------------------------------------------------------------------------------------------- "

    &header_printed=1
  )

  return


;-----------------------------------------------------------------------------
; Display help
;-----------------------------------------------------------------------------

Help:

  ;-----------------------------------------------------------------------------
  ; Display available clock sources that can be output to the clock test output
  ; and prompt for selection.
  ;-----------------------------------------------------------------------------

  AREA.Create HELP 130. 1000.
  AREA.View HELP
  AREA.Select HELP
  winresize 130. 24.

  print " "
  print " "
  gosub Print_Clock_Help
  print ""
  print "*** Clock groups***   "
  print "  all        - all clocks"
  print "  all_on     - all clocks that are on"
  print "  <ss>_all   - all subsystem clocks"
  print "  <wildcard> - search query"
  print "  file       - file specifying enumerated clocks (separated by newlines)"
  print "  on/off     - modifies on/off state of previously selected clock(s)"
  print "  set        - sets the clock to one of supported frequencies"
  print "  buses      - show all bus clocks"
  print "  cpus       - show all cpu clocks"
  
  print "*** Other options ***"
  print "  x   - exit"
  print "  ?   - help"
  print "  .   - repeat (also carriage return without any arguments)" 
  print "*** Debug options ***"
  print "   gpio       - enable GPIO's for clock output"
  print ""

  AREA.Select CLOCK

  return


;-----------------------------------------------------------------------------
; Display clock info line
;-----------------------------------------------------------------------------

Print_Clk_Info_Line:

  &is_on=0
  &clk_freq=0
  &clk_reg_val=0

  ; Set the default name
  &clk_name=string.cut("&clk_name                                           ", -string.len("&clk_name"))
  
  ;-----------------------------------------------------------------------------
  ; Toggle clock state if requested
  ;-----------------------------------------------------------------------------
  if (&clk_reg!=0)
  (
    if "&state_change"=="on"
    (
      data.set &clk_access_mod&clk_reg %LONG (data.long(&clk_access_mod&clk_reg)|0x00000001)
    )
    else if "&state_change"=="off"
    (
      data.set &clk_access_mod&clk_reg %LONG (data.long(&clk_access_mod&clk_reg)&~(0x00000001))
    )
  )

  if "&state_change"=="set"
  (
    gosub Set_Clock_Freq_Enter
  )

  ;-----------------------------------------------------------------------------
  ; Print the clock header
  ;-----------------------------------------------------------------------------
  gosub Print_Header

  ;-----------------------------------------------------------------------------
  ; Test if clock is on
  ;-----------------------------------------------------------------------------
  
  if (&clk_reg!=0)
  (
    if (data.long(&clk_access_mod&clk_reg)&(0x80000000))==0x0
    (
      &clk_state="ON "
      &is_on=1
    )
    else
    (
      &clk_state="OFF"
      &is_on=0
    )
  )
  else
  (
    &clk_state=" ? " 
    &is_on=1
  )
  
  ;-----------------------------------------------------------------------------
  ; Calculate the clock frequency based on the TCXO counter
  ;-----------------------------------------------------------------------------

  if (&clk_test!=0)&&(&is_on==1)
  (
    gosub Program_Clk_Test

    gosub Calc_Clock_Freq

    if (&clk_freq==0)
    (
      &clk_freq_str=FORMAT.DECIMAL(14., 0x0)
    )
    else
    (
      &clk_freq_str=FORMAT.FLOAT(12., 0x6, &clk_freq) 
    )
  )
  else if (&is_on==0)
  (
    &clk_freq_str=FORMAT.DECIMAL(14., 0x0)
  )
  else
  (
    &clk_freq_str="  Not Testable"
  )
  
  if (&print_if_off==1)||(&is_on==0x1)
  (
    if (&clk_reg!=0)
    (
      &clk_reg_val=FORMAT.HEX(0x8, data.long(&clk_access_mod&clk_reg))
      &clk_reg_val_str="0x&clk_reg_val"
      
      &clk_reg=FORMAT.HEX(0x8, &clk_reg)
      &clk_reg_str="0x&clk_reg"
    )
    else
    (
      &clk_reg_str="----------" 
      &clk_reg_val_str="----------"
    )

    print "&clk_name &clk_state       &clk_freq_str         &clk_reg_str : &clk_reg_val_str   &clk_reg_cbcr_type"
  )

  return


;-----------------------------------------------------------------------------
; Determine clock frequency.
;-----------------------------------------------------------------------------

Calc_Clock_Freq:

  local &l2cpucpselr_val
  local &l2cpucpcpdr_val

  ; Disable auto-gating on L2 clock to get accurate frequency.
  ;if (cpu()=="KRAIT")&&(&clk_test==&CLK_TEST_APCS_L2_CLK)
  ;(
  ;  &l2cpucpselr_val=data.long(c15:0x360f)
  ;  data.set c15:0x360f %LONG 0x500
  ;  &l2cpucpcpdr_val=data.long(c15:0x370f)
  ;  data.set c15:0x370f %LONG (&l2cpucpcpdr_val|0xc00)
  ;)

  ; Save current values
  &xo_div4_cbcr=data.long(a:&HWIO_GCC_XO_DIV4_CBCR_ADDR)
  
  ; Measure a short run
  &multiplier=4
  &tcxo_count=0x800
  
  ; Config XO DIV4 comparator clock
  data.set a:&HWIO_GCC_XO_DIV4_CBCR_ADDR %LONG data.long(a:&HWIO_GCC_XO_DIV4_CBCR_ADDR)|0x1
  
  ; Start with the counter disabled 
  &measure_ctl=data.long(a:&HWIO_GCC_CLOCK_FRQ_MEASURE_CTL_ADDR)
  &measure_ctl=&measure_ctl&~0x1FFFFF
  data.set a:&HWIO_GCC_CLOCK_FRQ_MEASURE_CTL_ADDR %LONG &measure_ctl
  
  ; Program the starting counter value, high enough to get good accuracy
  &measure_ctl=&measure_ctl|&tcxo_count
  
  ; Start the counting
  &measure_ctl=&measure_ctl|0x100000
  data.set a:&HWIO_GCC_CLOCK_FRQ_MEASURE_CTL_ADDR %LONG &measure_ctl
  
  ; Wait for the counters to finish
  wait 1.ms
  while (data.long(a:&HWIO_GCC_CLOCK_FRQ_MEASURE_STATUS_ADDR)&0x2000000)==0
  (
  )
  
  ; Turn off the test clock and read the clock count
  &measure_ctl=data.long(a:&HWIO_GCC_CLOCK_FRQ_MEASURE_CTL_ADDR)
  data.set a:&HWIO_GCC_CLOCK_FRQ_MEASURE_CTL_ADDR %LONG (&measure_ctl&~0x100000)
  
  &short_clock_count=data.long(a:&HWIO_GCC_CLOCK_FRQ_MEASURE_STATUS_ADDR)&0x1FFFFFF
  
  ; Restore the registers
  data.set a:&HWIO_GCC_XO_DIV4_CBCR_ADDR %LONG &xo_div4_cbcr
 
  ; Now do a longer count and compare
  ; Save current values
  &xo_div4_cbcr=data.long(a:&HWIO_GCC_XO_DIV4_CBCR_ADDR)
  
  &multiplier=4
  &tcxo_count=0x8000
  
  ; Config XO DIV4 comparator clock
  data.set a:&HWIO_GCC_XO_DIV4_CBCR_ADDR %LONG data.long(a:&HWIO_GCC_XO_DIV4_CBCR_ADDR)|0x1
  
  ; Start with the counter disabled 
  &measure_ctl=data.long(a:&HWIO_GCC_CLOCK_FRQ_MEASURE_CTL_ADDR)
  &measure_ctl=&measure_ctl&~0x1FFFFF
  data.set a:&HWIO_GCC_CLOCK_FRQ_MEASURE_CTL_ADDR %LONG &measure_ctl
  
  ; Program the starting counter value, high enough to get good accuracy
  &measure_ctl=&measure_ctl|&tcxo_count
  
  ; Start the counting
  &measure_ctl=&measure_ctl|0x100000
  data.set a:&HWIO_GCC_CLOCK_FRQ_MEASURE_CTL_ADDR %LONG &measure_ctl
  
  ; Wait for the counters to finish
  wait 1.ms
  while (data.long(a:&HWIO_GCC_CLOCK_FRQ_MEASURE_STATUS_ADDR)&0x2000000)==0
  (
  )
  
  ; Turn off the test clock and read the clock count
  &measure_ctl=data.long(a:&HWIO_GCC_CLOCK_FRQ_MEASURE_CTL_ADDR)
  data.set a:&HWIO_GCC_CLOCK_FRQ_MEASURE_CTL_ADDR %LONG (&measure_ctl&~0x100000)
  
  &clock_count=data.long(a:&HWIO_GCC_CLOCK_FRQ_MEASURE_STATUS_ADDR)&0x1FFFFFF
  
  ; Calculate the frequency.  Function is provided by
  ; Power Control 42.8.1.2 Measurement technique
  ; f ring = f tcxo/4 * (Nring + 1.5) / (TCtcxo + 3.5)
  ;
  ; The formula below is the equivalent one converted
  ; to integer arithmetic.
  ; 
  ; We add half of the denominator value to the dividend
  ; to guard against rounding errors inherent to
  ; integer arithmetic.
  ;
  
  if &clock_count==&short_clock_count
  (
    &clk_freq=0
  )
  else
  (
    &clk_freq=4.800*(&multiplier)*(&clock_count+1.5)/(&tcxo_count+3.5)
  )
  
  ; Restore the registers
  data.set a:&HWIO_GCC_XO_DIV4_CBCR_ADDR %LONG &xo_div4_cbcr
  
  ; Clear the divide by 4 in DEBUG_CLK_CTL to make the scope view of the clock
  ; the correct frequency
  &dbg_clk_ctl=data.long(a:&HWIO_GCC_DEBUG_CLK_CTL_ADDR)
  &dbg_clk_ctl=&dbg_clk_ctl&~0x00003000
  data.set a:&HWIO_GCC_DEBUG_CLK_CTL_ADDR %LONG &dbg_clk_ctl

  ; Restore the original auto-gating behavior.
  ;if (cpu()=="KRAIT")&&(&clk_test==&CLK_TEST_APCS_L2_CLK)
  ;(
  ;  data.set c15:0x370f %LONG &l2cpucpcpdr_val
  ;  data.set c15:0x360f %LONG &l2cpucpselr_val
  ;)

  return


;-----------------------------------------------------------------------------
; Determine clock frequency.
;-----------------------------------------------------------------------------

Set_Clock_Freq:

  ; Use testpll.cmm to turn on required source
  do testpll.cmm on &clk_src_name

  ; Convert src divider to appropriate register value
  if (&clk_src_div!=0)
  (
    &clk_src_div=&clk_src_div-1
  )

  ; Read current cmd_rcgr and cfg_rcgr values
  &clk_cmd_rcgr_val=data.long(&clk_access_mod&clk_cmd_rcgr_addr)
  &clk_cfg_rcgr_val=data.long(&clk_access_mod&clk_cfg_rcgr_addr)

  ; Clear src_sel, src_div, and mode fields
  &clk_cfg_rcgr_val=&clk_cfg_rcgr_val&~(&HAL_CLK_CFG_CGR_SRC_SEL_FMSK|&HAL_CLK_CFG_CGR_SRC_DIV_FMSK|&HAL_CLK_CFG_CGR_MODE_FMSK)

  ; Program src_sel and src_div
  &clk_cfg_rcgr_val=&clk_cfg_rcgr_val|((&clk_src_sel<<&HAL_CLK_CFG_CGR_SRC_SEL_SHFT)&(&HAL_CLK_CFG_CGR_SRC_SEL_FMSK))
  &clk_cfg_rcgr_val=&clk_cfg_rcgr_val|((&clk_src_div<<&HAL_CLK_CFG_CGR_SRC_DIV_SHFT)&(&HAL_CLK_CFG_CGR_SRC_DIV_FMSK))

  ; Program M, N, D registers if necessary
  if (&clk_m_val!=0.)&&(&clk_m_val<&clk_n_val)
  (
    &clk_m_addr=&clk_cmd_rcgr_addr+&HAL_CLK_M_REG_OFFSET
    &clk_n_addr=&clk_cmd_rcgr_addr+&HAL_CLK_N_REG_OFFSET
    &clk_2d_addr=&clk_cmd_rcgr_addr+&HAL_CLK_D_REG_OFFSET

    ; Write to M register
    data.set &clk_access_mod&clk_m_addr %long &clk_m_val
    
    ; Write to N register
    data.set &clk_access_mod&clk_n_addr %long ~(&clk_n_val-&clk_m_val)
    
    ; Write to D register
    data.set &clk_access_mod&clk_2d_addr %long ~&clk_2d_val
    
    ; Dual edge mode
    &clk_cfg_rcgr_val=&clk_cfg_rcgr_val|((&HAL_CLK_CFG_CFG_DUAL_EDGE_MODE_VAL<<&HAL_CLK_CFG_CGR_MODE_SHFT)&(&HAL_CLK_CFG_CGR_MODE_FMSK))
  )
  
  ; Write to cfg_rcgr
  data.set &clk_access_mod&clk_cfg_rcgr_addr %long &clk_cfg_rcgr_val

  ; Write to cmd_rcgr to trigger update
  data.set &clk_access_mod&clk_cmd_rcgr_addr %long (&clk_cmd_rcgr_val|&HAL_CLK_CMD_CFG_UPDATE_FMSK)

  ; Wait for update to finish
  wait 1.ms
  while (data.long(&clk_access_mod&clk_cmd_rcgr_addr)&(&HAL_CLK_CMD_CFG_UPDATE_FMSK))!=0
  (
  )

  return


;-----------------------------------------------------------------------------
; Program the clk_test register
;-----------------------------------------------------------------------------

Program_Clk_Test:

  &testval=&clk_test&(&CLK_TEST_TYPE_MASK)
  &selval=&clk_test&(&CLK_TEST_SEL_MASK)
  &submuxval=&clk_test&(&CLK_TEST_SUB_MUX_MASK)

  ; GCC
  if &selval==&CLK_GCC_TEST
  (
    data.set a:&HWIO_GCC_DEBUG_CLK_CTL_ADDR %LONG 0x00013000|(&testval&0x000001FF)
    ; No sub-system config
  )
  ; MSS
  if &selval==&CLK_MSS_TEST
  (
    data.set a:&HWIO_GCC_DEBUG_CLK_CTL_ADDR %LONG 0x00013000|(0x32&0x000001FF)
    
    ; Check for tests on each sub-mux and redirect MSS test clock accordingly
    
    if &submuxval==&CLK_MSS_SUB_MUX_MODEM
    (
      ; Config the MSS debug mux to route signals to the modem debug ctl
      data.set a:&HWIO_MSS_DEBUG_CLOCK_CTL_ADDR %LONG 0x15
      
      ; Config the modem debug ctl
      data.set a:&HWIO_MODEM_CLK_DBG_CFG_ADDR %LONG (&testval&0x00000007)
    )
    else if &submuxval==&CLK_MSS_SUB_MUX_NAV
    (
      ; Config the MSS debug mux to route signals to the nav debug ctl
      data.set a:&HWIO_MSS_DEBUG_CLOCK_CTL_ADDR %LONG 0x16
      
      ; Read out current contents of the nav clock control register
      &nav_clk_ctl_val=data.long(a:&HWIO_MSS_NAV_CLK_CTL_ADDR)
      
      ; Clear out the debug mux config field
      &nav_clk_ctl_val=&nav_clk_ctl_val&~(0x3<<0xD)
      
      ; Update the debug mux config field with the new test val
      &nav_clk_ctl_val=&nav_clk_ctl_val|((&testval&0x00000003)<<0xD)
      
      data.set a:&HWIO_MSS_NAV_CLK_CTL_ADDR %LONG &nav_clk_ctl_val
    )
    else if &submuxval==&CLK_MSS_SUB_MUX_Q6
    (
      ; Config the MSS debug mux to route signals to the qdsp6ss debug ctl
      data.set a:&HWIO_MSS_DEBUG_CLOCK_CTL_ADDR %LONG 0x17
      
      ; Config the MSS qdsp6ss debug ctl
      data.set a:&HWIO_MSS_QDSP6SS_TEST_CLK_CTL_ADDR %LONG 0x00000020|(&testval&0x0000001F)
    )
    else
    (
      data.set a:&HWIO_MSS_DEBUG_CLOCK_CTL_ADDR %LONG (&testval&0x0000003F)
    )
  )
  ; WCSS
  if &selval==&CLK_WCSS_TEST
  (
    data.set a:&HWIO_GCC_DEBUG_CLK_CTL_ADDR %LONG 0x00013000|(0x198&0x000001FF)
    data.set a:&HWIO_WCSS_A_PMU_WCSS_DEBUG_CLK_CTL_ADDR %LONG 0x00000000|(&testval&0x00000FFF)
  )
  if &selval==&CLK_APCS_TEST
  (
    data.set a:&HWIO_GCC_DEBUG_CLK_CTL_ADDR %LONG 0x00013000|(0x16A&0x000001FF)
    data.set a:&HWIO_APCS_GLB_CLK_DIAG_ADDR %LONG 0x00000000|(&testval&0x7FFF)
  )
  
  return
  



Init_Constants:

; CBCR addresses for clocks

&HWIO_GCC_APSS_AHB_CBCR_ADDR=0x184601c
&HWIO_GCC_APSS_AXI_CBCR_ADDR=0x1846020
&HWIO_GCC_ULTAUDIO_AHBFABRIC_IXFABRIC_CBCR_ADDR=0x181c028
&HWIO_GCC_ULTAUDIO_AHBFABRIC_IXFABRIC_LPM_CBCR_ADDR=0x181c024
&HWIO_GCC_ULTAUDIO_PCNOC_MPORT_CBCR_ADDR=0x181c000
&HWIO_GCC_ULTAUDIO_PCNOC_SWAY_CBCR_ADDR=0x181c004
&HWIO_GCC_ULTAUDIO_AVSYNC_XO_CBCR_ADDR=0x181c04c
&HWIO_GCC_ULTAUDIO_STC_XO_CBCR_ADDR=0x181c050
&HWIO_GCC_CODEC_DIGCODEC_CBCR_ADDR=0x181c0b0
&HWIO_GCC_BIMC_APSS_AXI_CBCR_ADDR=0x1831020
&HWIO_GCC_BIMC_CFG_AHB_CBCR_ADDR=0x183100c
&HWIO_GCC_BIMC_CBCR_ADDR=0x183101c
&HWIO_GCC_BIMC_GPU_CBCR_ADDR=0x1831040
&HWIO_GCC_BIMC_SLEEP_CBCR_ADDR=0x1831010
&HWIO_GCC_BIMC_SYSNOC_AXI_CBCR_ADDR=0x1831014
&HWIO_GCC_BIMC_TCU_CBCR_ADDR=0x1831044
&HWIO_GCC_BIMC_XO_CBCR_ADDR=0x1831008
&HWIO_GCC_BLSP1_AHB_CBCR_ADDR=0x1801008
&HWIO_GCC_BLSP1_SLEEP_CBCR_ADDR=0x1801004
&HWIO_GCC_BLSP1_QUP1_I2C_APPS_CBCR_ADDR=0x1802008
&HWIO_GCC_BLSP1_QUP1_SPI_APPS_CBCR_ADDR=0x1802004
&HWIO_GCC_BLSP1_QUP2_I2C_APPS_CBCR_ADDR=0x1803010
&HWIO_GCC_BLSP1_QUP2_SPI_APPS_CBCR_ADDR=0x180300c
&HWIO_GCC_BLSP1_QUP3_I2C_APPS_CBCR_ADDR=0x1804020
&HWIO_GCC_BLSP1_QUP3_SPI_APPS_CBCR_ADDR=0x180401c
&HWIO_GCC_BLSP1_QUP4_I2C_APPS_CBCR_ADDR=0x1805020
&HWIO_GCC_BLSP1_QUP4_SPI_APPS_CBCR_ADDR=0x180501c
&HWIO_GCC_BLSP1_QUP5_I2C_APPS_CBCR_ADDR=0x1806020
&HWIO_GCC_BLSP1_QUP5_SPI_APPS_CBCR_ADDR=0x180601c
&HWIO_GCC_BLSP1_QUP6_I2C_APPS_CBCR_ADDR=0x1807020
&HWIO_GCC_BLSP1_QUP6_SPI_APPS_CBCR_ADDR=0x180701c
&HWIO_GCC_BLSP1_UART1_APPS_CBCR_ADDR=0x180203c
&HWIO_GCC_BLSP1_UART1_SIM_CBCR_ADDR=0x1802040
&HWIO_GCC_BLSP1_UART2_APPS_CBCR_ADDR=0x180302c
&HWIO_GCC_BLSP1_UART2_SIM_CBCR_ADDR=0x1803030
&HWIO_GCC_BOOT_ROM_AHB_CBCR_ADDR=0x181300c
&HWIO_GCC_CAMSS_CSI0_AHB_CBCR_ADDR=0x184e040
&HWIO_GCC_CAMSS_CSI0_CBCR_ADDR=0x184e03c
&HWIO_GCC_CAMSS_CSI0PHY_CBCR_ADDR=0x184e048
&HWIO_GCC_CAMSS_CSI0PIX_CBCR_ADDR=0x184e058
&HWIO_GCC_CAMSS_CSI0RDI_CBCR_ADDR=0x184e050
&HWIO_GCC_CAMSS_CSI1_AHB_CBCR_ADDR=0x184f040
&HWIO_GCC_CAMSS_CSI1_CBCR_ADDR=0x184f03c
&HWIO_GCC_CAMSS_CSI1PHY_CBCR_ADDR=0x184f048
&HWIO_GCC_CAMSS_CSI1PIX_CBCR_ADDR=0x184f058
&HWIO_GCC_CAMSS_CSI1RDI_CBCR_ADDR=0x184f050
&HWIO_GCC_CAMSS_CSI_VFE0_CBCR_ADDR=0x1858050
&HWIO_GCC_CAMSS_GP0_CBCR_ADDR=0x1854018
&HWIO_GCC_CAMSS_GP1_CBCR_ADDR=0x1855018
&HWIO_GCC_CAMSS_ISPIF_AHB_CBCR_ADDR=0x1850004
&HWIO_GCC_CAMSS_MCLK0_CBCR_ADDR=0x1852018
&HWIO_GCC_CAMSS_MCLK1_CBCR_ADDR=0x1853018
&HWIO_GCC_CAMSS_AHB_CBCR_ADDR=0x1856004
&HWIO_GCC_CAMSS_TOP_AHB_CBCR_ADDR=0x185a014
&HWIO_GCC_CAMSS_VFE0_CBCR_ADDR=0x1858038
&HWIO_GCC_CAMSS_VFE_AHB_CBCR_ADDR=0x1858044
&HWIO_GCC_CAMSS_VFE_AXI_CBCR_ADDR=0x1858048
&HWIO_GCC_CRYPTO_AHB_CBCR_ADDR=0x1816024
&HWIO_GCC_CRYPTO_AXI_CBCR_ADDR=0x1816020
&HWIO_GCC_CRYPTO_CBCR_ADDR=0x181601c
&HWIO_GCC_DCD_XO_CBCR_ADDR=0x182a004
&HWIO_GCC_DDR_DIM_CFG_CBCR_ADDR=0x183201c
&HWIO_GCC_DDR_DIM_SLEEP_CBCR_ADDR=0x1832020
&HWIO_GCC_PCNOC_DDR_CFG_CBCR_ADDR=0x1832024
&HWIO_GCC_DEHR_CBCR_ADDR=0x181f004
&HWIO_GCC_AHB_CBCR_ADDR=0x1830014
&HWIO_GCC_IM_SLEEP_CBCR_ADDR=0x1830038
&HWIO_GCC_XO_CBCR_ADDR=0x1830030
&HWIO_GCC_XO_DIV4_CBCR_ADDR=0x1830034
&HWIO_GCC_SPDM_AHB_CBCR_ADDR=0x182f040
&HWIO_GCC_SPDM_CSI0_CBCR_ADDR=0x182f048
&HWIO_GCC_SPDM_GFX3D_CBCR_ADDR=0x182f03c
&HWIO_GCC_SPDM_MDP_CBCR_ADDR=0x182f02c
&HWIO_GCC_SPDM_PCLK0_CBCR_ADDR=0x182f044
&HWIO_GCC_SPDM_VCODEC0_CBCR_ADDR=0x182f034
&HWIO_GCC_SPDM_VFE0_CBCR_ADDR=0x182f038
&HWIO_GCC_GP1_CBCR_ADDR=0x1808000
&HWIO_GCC_GP2_CBCR_ADDR=0x1809000
&HWIO_GCC_GP3_CBCR_ADDR=0x180a000
&HWIO_GCC_IMEM_AXI_CBCR_ADDR=0x180e004
&HWIO_GCC_IMEM_CFG_AHB_CBCR_ADDR=0x180e008
&HWIO_GCC_MDSS_AHB_CBCR_ADDR=0x184d07c
&HWIO_GCC_MDSS_AXI_CBCR_ADDR=0x184d080
&HWIO_GCC_MDSS_BYTE0_CBCR_ADDR=0x184d094
&HWIO_GCC_MDSS_ESC0_CBCR_ADDR=0x184d098
&HWIO_GCC_MDSS_MDP_CBCR_ADDR=0x184d088
&HWIO_GCC_MDSS_PCLK0_CBCR_ADDR=0x184d084
&HWIO_GCC_MDSS_VSYNC_CBCR_ADDR=0x184d090
&HWIO_GCC_MPM_AHB_CBCR_ADDR=0x182c008
&HWIO_GCC_MSG_RAM_AHB_CBCR_ADDR=0x182b004
&HWIO_GCC_MSS_CFG_AHB_CBCR_ADDR=0x1849000
&HWIO_GCC_MSS_Q6_BIMC_AXI_CBCR_ADDR=0x1849004
&HWIO_GCC_NOC_CONF_XPU_AHB_CBCR_ADDR=0x1817000
&HWIO_GCC_BIMC_GFX_CBCR_ADDR=0x1831024
&HWIO_GCC_OXILI_AHB_CBCR_ADDR=0x1859028
&HWIO_GCC_OXILI_GFX3D_CBCR_ADDR=0x1859020
&HWIO_GCC_PCNOC_AHB_CBCR_ADDR=0x182701c
&HWIO_GCC_PCNOC_AT_CBCR_ADDR=0x1827028
&HWIO_GCC_PCNOC_RPM_AHB_CBCR_ADDR=0x1827024
&HWIO_GCC_PCNOC_BUS_TIMEOUT0_AHB_CBCR_ADDR=0x1848004
&HWIO_GCC_PCNOC_BUS_TIMEOUT1_AHB_CBCR_ADDR=0x184800c
&HWIO_GCC_PCNOC_BUS_TIMEOUT2_AHB_CBCR_ADDR=0x1848014
&HWIO_GCC_PCNOC_BUS_TIMEOUT3_AHB_CBCR_ADDR=0x184801c
&HWIO_GCC_PCNOC_BUS_TIMEOUT4_AHB_CBCR_ADDR=0x1848024
&HWIO_GCC_PCNOC_BUS_TIMEOUT5_AHB_CBCR_ADDR=0x184802c
&HWIO_GCC_PCNOC_BUS_TIMEOUT6_AHB_CBCR_ADDR=0x1848034
&HWIO_GCC_PCNOC_BUS_TIMEOUT7_AHB_CBCR_ADDR=0x184803c
&HWIO_GCC_PCNOC_BUS_TIMEOUT8_AHB_CBCR_ADDR=0x1848044
&HWIO_GCC_PCNOC_BUS_TIMEOUT9_AHB_CBCR_ADDR=0x184804c
&HWIO_GCC_PDM2_CBCR_ADDR=0x184400c
&HWIO_GCC_PDM_AHB_CBCR_ADDR=0x1844004
&HWIO_GCC_PDM_XO4_CBCR_ADDR=0x1844008
&HWIO_GCC_PRNG_AHB_CBCR_ADDR=0x1813004
&HWIO_GCC_QDSS_AT_CBCR_ADDR=0x1829024
&HWIO_GCC_QDSS_CFG_AHB_CBCR_ADDR=0x1829008
&HWIO_GCC_QDSS_DAP_AHB_CBCR_ADDR=0x1829004
&HWIO_GCC_QDSS_DAP_CBCR_ADDR=0x1829084
&HWIO_GCC_QDSS_ETR_USB_CBCR_ADDR=0x1829028
&HWIO_GCC_QDSS_STM_CBCR_ADDR=0x1829044
&HWIO_GCC_QDSS_TRACECLKIN_CBCR_ADDR=0x1829060
&HWIO_GCC_QDSS_TSCTR_DIV16_CBCR_ADDR=0x1829090
&HWIO_GCC_QDSS_TSCTR_DIV2_CBCR_ADDR=0x182907c
&HWIO_GCC_QDSS_TSCTR_DIV3_CBCR_ADDR=0x1829080
&HWIO_GCC_QDSS_TSCTR_DIV4_CBCR_ADDR=0x1829088
&HWIO_GCC_QDSS_TSCTR_DIV8_CBCR_ADDR=0x182908c
&HWIO_GCC_QPIC_AHB_CBCR_ADDR=0x183f01c
&HWIO_GCC_QPIC_CBCR_ADDR=0x183f018
&HWIO_GCC_QPIC_SYSTEM_CBCR_ADDR=0x183f020
&HWIO_GCC_RBCPR_AHB_CBCR_ADDR=0x1833008
&HWIO_GCC_RBCPR_CBCR_ADDR=0x1833004
&HWIO_GCC_RPM_BUS_AHB_CBCR_ADDR=0x182d004
&HWIO_GCC_RPM_PROC_HCLK_CBCR_ADDR=0x182d000
&HWIO_GCC_RPM_SLEEP_CBCR_ADDR=0x182d008
&HWIO_GCC_RPM_TIMER_CBCR_ADDR=0x182d00c
&HWIO_GCC_RPM_CFG_XPU_CBCR_ADDR=0x1817004
&HWIO_GCC_SDCC1_AHB_CBCR_ADDR=0x184201c
&HWIO_GCC_SDCC1_APPS_CBCR_ADDR=0x1842018
&HWIO_GCC_SDCC2_AHB_CBCR_ADDR=0x184301c
&HWIO_GCC_SDCC2_APPS_CBCR_ADDR=0x1843018
&HWIO_GCC_APSS_TCU_ASYNC_CBCR_ADDR=0x1812098
&HWIO_GCC_APSS_TCU_CBCR_ADDR=0x1812018
&HWIO_GCC_GFX_TBU_CBCR_ADDR=0x1812010
&HWIO_GCC_GFX_TCU_CBCR_ADDR=0x1812020
&HWIO_GCC_GTCU_AHB_CBCR_ADDR=0x1812044
&HWIO_GCC_MDP_TBU_CBCR_ADDR=0x181201c
&HWIO_GCC_MSS_TBU_Q6_AXI_CBCR_ADDR=0x181202c
&HWIO_GCC_MSS_TBU_AXI_CBCR_ADDR=0x1812024
&HWIO_GCC_MSS_TBU_GSS_AXI_CBCR_ADDR=0x1812028
&HWIO_GCC_PCNOC_TBU_CBCR_ADDR=0x1812030
&HWIO_GCC_PRONTO_TBU_CBCR_ADDR=0x1812048
&HWIO_GCC_SMMU_CATS_CBCR_ADDR=0x187c004
&HWIO_GCC_SMMU_CFG_CBCR_ADDR=0x1812038
&HWIO_GCC_SMMU_XPU_CBCR_ADDR=0x1817010
&HWIO_GCC_VENUS_TBU_CBCR_ADDR=0x1812014
&HWIO_GCC_VFE_TBU_CBCR_ADDR=0x181203c
&HWIO_GCC_SNOC_BUS_TIMEOUT0_AHB_CBCR_ADDR=0x1847004
&HWIO_GCC_SPDM_BIMC_CY_CBCR_ADDR=0x182f010
&HWIO_GCC_SPDM_CFG_AHB_CBCR_ADDR=0x182f004
&HWIO_GCC_SPDM_FF_CBCR_ADDR=0x182f00c
&HWIO_GCC_SPDM_MSTR_AHB_CBCR_ADDR=0x182f008
&HWIO_GCC_SPDM_PCNOC_CY_CBCR_ADDR=0x182f01c
&HWIO_GCC_SPDM_RPM_CY_CBCR_ADDR=0x182f020
&HWIO_GCC_SPDM_SNOC_CY_CBCR_ADDR=0x182f014
&HWIO_GCC_ULTAUDIO_AHBFABRIC_EFABRIC_SPDM_CBCR_ADDR=0x181c030
&HWIO_GCC_SPMI_AHB_CBCR_ADDR=0x182e03c
&HWIO_GCC_SPMI_PCNOC_AHB_CBCR_ADDR=0x182e020
&HWIO_GCC_SPMI_SER_CBCR_ADDR=0x182e01c
&HWIO_GCC_SEC_CTRL_ACC_CBCR_ADDR=0x181a020
&HWIO_GCC_SEC_CTRL_AHB_CBCR_ADDR=0x181a024
&HWIO_GCC_SEC_CTRL_BOOT_ROM_PATCH_CBCR_ADDR=0x181a030
&HWIO_GCC_SEC_CTRL_CBCR_ADDR=0x181a028
&HWIO_GCC_SEC_CTRL_SENSE_CBCR_ADDR=0x181a02c
&HWIO_GCC_SNOC_PCNOC_AHB_CBCR_ADDR=0x182602c
&HWIO_GCC_SYS_NOC_APSS_AHB_CBCR_ADDR=0x1826028
&HWIO_GCC_SYS_NOC_AT_CBCR_ADDR=0x1826030
&HWIO_GCC_SYS_NOC_AXI_CBCR_ADDR=0x1826020
&HWIO_GCC_SYS_NOC_QDSS_STM_AXI_CBCR_ADDR=0x1826024
&HWIO_GCC_TCSR_AHB_CBCR_ADDR=0x1828004
&HWIO_GCC_TLMM_AHB_CBCR_ADDR=0x1834004
&HWIO_GCC_TLMM_CBCR_ADDR=0x1834008
&HWIO_GCC_ULTAUDIO_LPAIF_AUX_I2S_CBCR_ADDR=0x181c098
&HWIO_GCC_ULTAUDIO_EXT_MCLK2_CBCR_ADDR=0x181c0ec
&HWIO_GCC_ULTAUDIO_PCM_DATA_OE_CBCR_ADDR=0x181c104
&HWIO_GCC_ULTAUDIO_LPAIF_PRI_I2S_CBCR_ADDR=0x181c068
&HWIO_GCC_ULTAUDIO_LPAIF_SEC_I2S_CBCR_ADDR=0x181c080
&HWIO_GCC_USB2A_PHY_SLEEP_CBCR_ADDR=0x184102c
&HWIO_GCC_USB_HS_PHY_CFG_AHB_CBCR_ADDR=0x1841030
&HWIO_GCC_USB_HS_AHB_CBCR_ADDR=0x1841008
&HWIO_GCC_USB_HS_INACTIVITY_TIMERS_CBCR_ADDR=0x184100c
&HWIO_GCC_USB_HS_SYSTEM_CBCR_ADDR=0x1841004
&HWIO_GCC_VENUS0_AHB_CBCR_ADDR=0x184c020
&HWIO_GCC_VENUS0_AXI_CBCR_ADDR=0x184c024
&HWIO_GCC_VENUS0_CORE0_VCODEC0_CBCR_ADDR=0x184c02c
&HWIO_GCC_VENUS0_VCODEC0_CBCR_ADDR=0x184c01c
&HWIO_GCC_PCNOC_MPU_CFG_AHB_CBCR_ADDR=0x181700c
&HWIO_GCC_PRNG_XPU_CFG_AHB_CBCR_ADDR=0x1817008
&HWIO_GCC_DEBUG_CLK_CTL_ADDR=0x1874000
&HWIO_WCSS_A_PMU_COMMON_AHB_CBCR_ADDR=0xa21b034
&HWIO_WCSS_A_PMU_COMMON_BT_32M_CBCR_ADDR=0xa21b038
&HWIO_WCSS_A_PMU_COMMON_BT_FM_19M_CBCR_ADDR=0xa21b03c
&HWIO_WCSS_A_PMU_COMMON_CPU_CBCR_ADDR=0xa21b030
&HWIO_WCSS_A_PMU_COMMON_PHY_DBG_CBCR_ADDR=0xa21b028
&HWIO_WCSS_A_PMU_COMMON_SLP_CBCR_ADDR=0xa21b040
&HWIO_WCSS_A_PMU_COMMON_TRC_CBCR_ADDR=0xa21b02c
&HWIO_WCSS_A_PMU_COMMON_XO_CBCR_ADDR=0xa21b044
&HWIO_WCSS_A_PMU_TOP_AHB_CBCR_ADDR=0xa21b008
&HWIO_WCSS_A_PMU_TOP_SLP_CBCR_ADDR=0xa21b010
&HWIO_WCSS_A_PMU_TOP_XO_CBCR_ADDR=0xa21b014
&HWIO_WCSS_A_PMU_DAC_SM_CBCR_ADDR=0xa21b084
&HWIO_WCSS_A_PMU_WLAN_AHB_CBCR_ADDR=0xa21b074
&HWIO_WCSS_A_PMU_WLAN_PHY_DAC_CBCR_ADDR=0xa21b070
&HWIO_WCSS_A_PMU_WLAN_PHY_DBG_CBCR_ADDR=0xa21b06c
&HWIO_WCSS_A_PMU_WLAN_PHY_MAIN1_FAST_CBCR_ADDR=0xa21b05c
&HWIO_WCSS_A_PMU_WLAN_RFA_CAL_CBCR_ADDR=0xa21b058
&HWIO_WCSS_A_PMU_WLAN_RFIF_CBCR_ADDR=0xa21b07c
&HWIO_WCSS_A_PMU_WLAN_PHY_MAIN1_RX_CBCR_ADDR=0xa21b064
&HWIO_WCSS_A_PMU_WLAN_PHY_MAIN1_TX_CBCR_ADDR=0xa21b060
&HWIO_WCSS_A_PMU_WLAN_PHY_MAIN2_CBCR_ADDR=0xa21b068
&HWIO_WCSS_A_PMU_WCSS_DEBUG_CLK_CTL_ADDR=0xa21b1e0
&HWIO_APCS_GLB_CLK_DIAG_ADDR=0xb01101c

; CMD and CFG RCGR addresses for configurable clocks

&HWIO_GCC_XO_DIV4_CBCR_ADDR=0x1830034
&HWIO_GCC_CLOCK_FRQ_MEASURE_CTL_ADDR=0x1874004
&HWIO_GCC_CLOCK_FRQ_MEASURE_STATUS_ADDR=0x1874008
&HWIO_TLMM_GPIO_CFG0_ADDR=0x1000000
&HWIO_MODEM_CLK_DBG_CFG_ADDR=0x4320030
&HWIO_MSS_NAV_CLK_CTL_ADDR=0x42f8008
&HWIO_MSS_QDSP6SS_TEST_CLK_CTL_ADDR=0x4082010
&HWIO_GCC_PLLTEST_PAD_CFG_ADDR=0x187400c

; Test Masks
&CLK_TEST_TYPE_MASK=(0x00007FFF)
&CLK_TEST_SEL_MASK=(0x000F0000)
&CLK_TEST_SUB_MUX_MASK=(0xF0000000)

;Sub-system Test Masks
&CLK_GCC_TEST=(0x1<<0x10)
&CLK_MSS_TEST=(0x2<<0x10)
&CLK_WCSS_TEST=(0x3<<0x10)
&CLK_APCS_TEST=(0x4<<0x10)
      
; GCC Sub Mux List
      
; MSS Sub Mux List
&CLK_MSS_SUB_MUX_MODEM=(0x1<<0x1C)
&CLK_MSS_SUB_MUX_NAV=(0x2<<0x1C)
&CLK_MSS_SUB_MUX_Q6=(0x3<<0x1C)
      
; WCSS Sub Mux List
      
; APCS Sub Mux List

; GCC Test Clocks
&CLK_TEST_APSS_GCC_DBG_CLK=(&CLK_GCC_TEST|0x16A)
&CLK_TEST_GCC_APSS_AHB_CLK=(&CLK_GCC_TEST|0x168)
&CLK_TEST_GCC_APSS_AXI_CLK=(&CLK_GCC_TEST|0x169)
&CLK_TEST_GCC_ULTAUDIO_AHBFABRIC_IXFABRIC_CLK=(&CLK_GCC_TEST|0x1B0)
&CLK_TEST_GCC_ULTAUDIO_AHBFABRIC_IXFABRIC_LPM_CLK=(&CLK_GCC_TEST|0x1B1)
&CLK_TEST_GCC_ULTAUDIO_PCNOC_MPORT_CLK=(&CLK_GCC_TEST|0x162)
&CLK_TEST_GCC_ULTAUDIO_PCNOC_SWAY_CLK=(&CLK_GCC_TEST|0x163)
&CLK_TEST_GCC_ULTAUDIO_AVSYNC_XO_CLK=(&CLK_GCC_TEST|0x1B5)
&CLK_TEST_GCC_ULTAUDIO_STC_XO_CLK=(&CLK_GCC_TEST|0x1B6)
&CLK_TEST_GCC_CODEC_DIGCODEC_CLK=(&CLK_GCC_TEST|0x1B7)
&CLK_TEST_GCC_BIMC_APSS_AXI_CLK=(&CLK_GCC_TEST|0x155)
&CLK_TEST_GCC_BIMC_AT_CLK=(&CLK_GCC_TEST|0x156)
&CLK_TEST_GCC_BIMC_CFG_AHB_CLK=(&CLK_GCC_TEST|0x151)
&CLK_TEST_GCC_BIMC_CLK=(&CLK_GCC_TEST|0x154)
&CLK_TEST_GCC_BIMC_GPU_CLK=(&CLK_GCC_TEST|0x157)
&CLK_TEST_GCC_BIMC_SLEEP_CLK=(&CLK_GCC_TEST|0x152)
&CLK_TEST_GCC_BIMC_SYSNOC_AXI_CLK=(&CLK_GCC_TEST|0x153)
&CLK_TEST_GCC_BIMC_TCU_CLK=(&CLK_GCC_TEST|0x159)
&CLK_TEST_GCC_BIMC_XO_CLK=(&CLK_GCC_TEST|0x150)
&CLK_TEST_GCC_BLSP1_AHB_CLK=(&CLK_GCC_TEST|0x088)
&CLK_TEST_GCC_BLSP1_SLEEP_CLK=(&CLK_GCC_TEST|0x089)
&CLK_TEST_GCC_BLSP1_QUP1_I2C_APPS_CLK=(&CLK_GCC_TEST|0x08B)
&CLK_TEST_GCC_BLSP1_QUP1_SPI_APPS_CLK=(&CLK_GCC_TEST|0x08A)
&CLK_TEST_GCC_BLSP1_QUP2_I2C_APPS_CLK=(&CLK_GCC_TEST|0x090)
&CLK_TEST_GCC_BLSP1_QUP2_SPI_APPS_CLK=(&CLK_GCC_TEST|0x08E)
&CLK_TEST_GCC_BLSP1_QUP3_I2C_APPS_CLK=(&CLK_GCC_TEST|0x094)
&CLK_TEST_GCC_BLSP1_QUP3_SPI_APPS_CLK=(&CLK_GCC_TEST|0x093)
&CLK_TEST_GCC_BLSP1_QUP4_I2C_APPS_CLK=(&CLK_GCC_TEST|0x099)
&CLK_TEST_GCC_BLSP1_QUP4_SPI_APPS_CLK=(&CLK_GCC_TEST|0x098)
&CLK_TEST_GCC_BLSP1_QUP5_I2C_APPS_CLK=(&CLK_GCC_TEST|0x09D)
&CLK_TEST_GCC_BLSP1_QUP5_SPI_APPS_CLK=(&CLK_GCC_TEST|0x09C)
&CLK_TEST_GCC_BLSP1_QUP6_I2C_APPS_CLK=(&CLK_GCC_TEST|0x0A2)
&CLK_TEST_GCC_BLSP1_QUP6_SPI_APPS_CLK=(&CLK_GCC_TEST|0x0A1)
&CLK_TEST_GCC_BLSP1_UART1_APPS_CLK=(&CLK_GCC_TEST|0x08C)
&CLK_TEST_GCC_BLSP1_UART1_SIM_CLK=(&CLK_GCC_TEST|0x08D)
&CLK_TEST_GCC_BLSP1_UART2_APPS_CLK=(&CLK_GCC_TEST|0x091)
&CLK_TEST_GCC_BLSP1_UART2_SIM_CLK=(&CLK_GCC_TEST|0x092)
&CLK_TEST_GCC_BOOT_ROM_AHB_CLK=(&CLK_GCC_TEST|0x0F8)
&CLK_TEST_GCC_CAMSS_CSI0_AHB_CLK=(&CLK_GCC_TEST|0x0C1)
&CLK_TEST_GCC_CAMSS_CSI0_CLK=(&CLK_GCC_TEST|0x0C0)
&CLK_TEST_GCC_CAMSS_CSI0PHY_CLK=(&CLK_GCC_TEST|0x0C2)
&CLK_TEST_GCC_CAMSS_CSI0PIX_CLK=(&CLK_GCC_TEST|0x0C4)
&CLK_TEST_GCC_CAMSS_CSI0RDI_CLK=(&CLK_GCC_TEST|0x0C3)
&CLK_TEST_GCC_CAMSS_CSI1_AHB_CLK=(&CLK_GCC_TEST|0x0C6)
&CLK_TEST_GCC_CAMSS_CSI1_CLK=(&CLK_GCC_TEST|0x0C5)
&CLK_TEST_GCC_CAMSS_CSI1PHY_CLK=(&CLK_GCC_TEST|0x0C7)
&CLK_TEST_GCC_CAMSS_CSI1PIX_CLK=(&CLK_GCC_TEST|0x0E1)
&CLK_TEST_GCC_CAMSS_CSI1RDI_CLK=(&CLK_GCC_TEST|0x0E0)
&CLK_TEST_GCC_CAMSS_CSI_VFE0_CLK=(&CLK_GCC_TEST|0x0BF)
&CLK_TEST_GCC_CAMSS_GP0_CLK=(&CLK_GCC_TEST|0x0AB)
&CLK_TEST_GCC_CAMSS_GP1_CLK=(&CLK_GCC_TEST|0x0AC)
&CLK_TEST_GCC_CAMSS_ISPIF_AHB_CLK=(&CLK_GCC_TEST|0x0E2)
&CLK_TEST_GCC_CAMSS_MCLK0_CLK=(&CLK_GCC_TEST|0x0AD)
&CLK_TEST_GCC_CAMSS_MCLK1_CLK=(&CLK_GCC_TEST|0x0AE)
&CLK_TEST_GCC_CAMSS_CSI0PHYTIMER_CLK=(&CLK_GCC_TEST|0x0B1)
&CLK_TEST_GCC_CAMSS_AHB_CLK=(&CLK_GCC_TEST|0x0A9)
&CLK_TEST_GCC_CAMSS_TOP_AHB_CLK=(&CLK_GCC_TEST|0x0A8)
&CLK_TEST_GCC_CAMSS_VFE0_CLK=(&CLK_GCC_TEST|0x0B8)
&CLK_TEST_GCC_CAMSS_VFE0_VBIF_CLK=(&CLK_GCC_TEST|0x0E3)
&CLK_TEST_GCC_CAMSS_VFE_AHB_CLK=(&CLK_GCC_TEST|0x0BB)
&CLK_TEST_GCC_CAMSS_VFE_AXI_CLK=(&CLK_GCC_TEST|0x0BC)
&CLK_TEST_GCC_CAMSS_VFE_VBIF_AHB_CLK=(&CLK_GCC_TEST|0x0BA)
&CLK_TEST_GCC_VFE_QDSS_AT_CLK=(&CLK_GCC_TEST|0x0BD)
&CLK_TEST_GCC_VFE_QDSS_TSCTR_DIV8_CLK=(&CLK_GCC_TEST|0x0BE)
&CLK_TEST_GCC_CRYPTO_AHB_CLK=(&CLK_GCC_TEST|0x13A)
&CLK_TEST_GCC_CRYPTO_AXI_CLK=(&CLK_GCC_TEST|0x139)
&CLK_TEST_GCC_CRYPTO_CLK=(&CLK_GCC_TEST|0x138)
&CLK_TEST_GCC_DCD_XO_CLK=(&CLK_GCC_TEST|0x1E0)
&CLK_TEST_GCC_DDR_DIM_CFG_CLK=(&CLK_GCC_TEST|0x158)
&CLK_TEST_GCC_DDR_DIM_SLEEP_CLK=(&CLK_GCC_TEST|0x15B)
&CLK_TEST_GCC_PCNOC_DDR_CFG_CLK=(&CLK_GCC_TEST|0x15A)
&CLK_TEST_GCC_DEHR_CLK=(&CLK_GCC_TEST|0x188)
&CLK_TEST_GCC_AHB_CLK=(&CLK_GCC_TEST|0x148)
&CLK_TEST_GCC_IM_SLEEP_CLK=(&CLK_GCC_TEST|0x14B)
&CLK_TEST_GCC_XO_CLK=(&CLK_GCC_TEST|0x149)
&CLK_TEST_GCC_XO_DIV4_CLK=(&CLK_GCC_TEST|0x14A)
&CLK_TEST_GCC_SPDM_AHB_CLK=(&CLK_GCC_TEST|0x142)
&CLK_TEST_GCC_SPDM_CSI0_CLK=(&CLK_GCC_TEST|0x140)
&CLK_TEST_GCC_SPDM_GFX3D_CLK=(&CLK_GCC_TEST|0x143)
&CLK_TEST_GCC_SPDM_MDP_CLK=(&CLK_GCC_TEST|0x146)
&CLK_TEST_GCC_SPDM_PCLK0_CLK=(&CLK_GCC_TEST|0x141)
&CLK_TEST_GCC_SPDM_VCODEC0_CLK=(&CLK_GCC_TEST|0x145)
&CLK_TEST_GCC_SPDM_VFE0_CLK=(&CLK_GCC_TEST|0x144)
&CLK_TEST_GCC_GP1_CLK=(&CLK_GCC_TEST|0x010)
&CLK_TEST_GCC_GP2_CLK=(&CLK_GCC_TEST|0x011)
&CLK_TEST_GCC_GP3_CLK=(&CLK_GCC_TEST|0x012)
&CLK_TEST_GCC_IMEM_AXI_CLK=(&CLK_GCC_TEST|0x020)
&CLK_TEST_GCC_IMEM_CFG_AHB_CLK=(&CLK_GCC_TEST|0x021)
&CLK_TEST_GCC_MDSS_AHB_CLK=(&CLK_GCC_TEST|0x1F6)
&CLK_TEST_GCC_MDSS_AXI_CLK=(&CLK_GCC_TEST|0x1F7)
&CLK_TEST_GCC_MDSS_BYTE0_CLK=(&CLK_GCC_TEST|0x1FC)
&CLK_TEST_GCC_MDSS_ESC0_CLK=(&CLK_GCC_TEST|0x1FD)
&CLK_TEST_GCC_MDSS_MDP_AHB_CLK=(&CLK_GCC_TEST|0x0B4)
&CLK_TEST_GCC_MDSS_MDP_CLK=(&CLK_GCC_TEST|0x1F9)
&CLK_TEST_GCC_MDSS_MDP_DSI_CLK=(&CLK_GCC_TEST|0x0B3)
&CLK_TEST_GCC_MDSS_MDP_VBIF_CLK=(&CLK_GCC_TEST|0x0B2)
&CLK_TEST_GCC_MDSS_PCLK0_CLK=(&CLK_GCC_TEST|0x1F8)
&CLK_TEST_GCC_MDSS_QDSS_AT_CLK=(&CLK_GCC_TEST|0x1FE)
&CLK_TEST_GCC_MDSS_QDSS_TSCTR_DIV8_CLK=(&CLK_GCC_TEST|0x1FF)
&CLK_TEST_GCC_MDSS_VSYNC_CLK=(&CLK_GCC_TEST|0x1FB)
&CLK_TEST_GCC_MPM_AHB_CLK=(&CLK_GCC_TEST|0x110)
&CLK_TEST_GCC_MSG_RAM_AHB_CLK=(&CLK_GCC_TEST|0x100)
&CLK_TEST_GCC_MSS_CFG_AHB_CLK=(&CLK_GCC_TEST|0x030)
&CLK_TEST_GCC_MSS_Q6_BIMC_AXI_CLK=(&CLK_GCC_TEST|0x031)
&CLK_TEST_MSS_GCC_DBG_CLK=(&CLK_GCC_TEST|0x032)
&CLK_TEST_GCC_NOC_CONF_XPU_AHB_CLK=(&CLK_GCC_TEST|0x018)
&CLK_TEST_APSS_GCC_RINGOSC_CLK=(&CLK_GCC_TEST|0x1D0)
&CLK_TEST_BIMC_PLL_DTEST=(&CLK_GCC_TEST|0x1C4)
&CLK_TEST_BIMC_PLL_LOCK_DET=(&CLK_GCC_TEST|0x1C5)
&CLK_TEST_GPLL0_DTEST=(&CLK_GCC_TEST|0x1C0)
&CLK_TEST_GPLL0_LOCK_DET=(&CLK_GCC_TEST|0x1C1)
&CLK_TEST_GPLL1_DTEST=(&CLK_GCC_TEST|0x1C2)
&CLK_TEST_GPLL1_LOCK_DET=(&CLK_GCC_TEST|0x1C3)
&CLK_TEST_MPM_GCC_TEMP_SENSOR_RINGOSC_CLK=(&CLK_GCC_TEST|0x1C8)
&CLK_TEST_USB2_PHY_GCC_ATEST_ULPI_0_CLK=(&CLK_GCC_TEST|0x1A0)
&CLK_TEST_USB2_PHY_GCC_ATEST_ULPI_1_CLK=(&CLK_GCC_TEST|0x1A8)
&CLK_TEST_WCSS_GCC_DBG_CLK=(&CLK_GCC_TEST|0x198)
&CLK_TEST_GCC_BIMC_GFX_CLK=(&CLK_GCC_TEST|0x02D)
&CLK_TEST_GCC_OXILI_AHB_CLK=(&CLK_GCC_TEST|0x1EB)
&CLK_TEST_GCC_OXILI_GFX3D_CLK=(&CLK_GCC_TEST|0x1EA)
&CLK_TEST_GCC_OXILI_QDSS_AT_CLK=(&CLK_GCC_TEST|0x1EC)
&CLK_TEST_GCC_OXILI_QDSS_TSCTR_DIV8_CLK=(&CLK_GCC_TEST|0x1ED)
&CLK_TEST_GCC_PCNOC_AHB_CLK=(&CLK_GCC_TEST|0x008)
&CLK_TEST_GCC_PCNOC_AT_CLK=(&CLK_GCC_TEST|0x00C)
&CLK_TEST_GCC_PCNOC_RPM_AHB_CLK=(&CLK_GCC_TEST|0x00A)
&CLK_TEST_GCC_PCNOC_TIC_CLK=(&CLK_GCC_TEST|0x00B)
&CLK_TEST_GCC_PCNOC_BUS_TIMEOUT0_AHB_CLK=(&CLK_GCC_TEST|0x178)
&CLK_TEST_GCC_PCNOC_BUS_TIMEOUT1_AHB_CLK=(&CLK_GCC_TEST|0x179)
&CLK_TEST_GCC_PCNOC_BUS_TIMEOUT2_AHB_CLK=(&CLK_GCC_TEST|0x17A)
&CLK_TEST_GCC_PCNOC_BUS_TIMEOUT3_AHB_CLK=(&CLK_GCC_TEST|0x17B)
&CLK_TEST_GCC_PCNOC_BUS_TIMEOUT4_AHB_CLK=(&CLK_GCC_TEST|0x17C)
&CLK_TEST_GCC_PCNOC_BUS_TIMEOUT5_AHB_CLK=(&CLK_GCC_TEST|0x180)
&CLK_TEST_GCC_PCNOC_BUS_TIMEOUT6_AHB_CLK=(&CLK_GCC_TEST|0x181)
&CLK_TEST_GCC_PCNOC_BUS_TIMEOUT7_AHB_CLK=(&CLK_GCC_TEST|0x182)
&CLK_TEST_GCC_PCNOC_BUS_TIMEOUT8_AHB_CLK=(&CLK_GCC_TEST|0x183)
&CLK_TEST_GCC_PCNOC_BUS_TIMEOUT9_AHB_CLK=(&CLK_GCC_TEST|0x184)
&CLK_TEST_GCC_PDM2_CLK=(&CLK_GCC_TEST|0x0D2)
&CLK_TEST_GCC_PDM_AHB_CLK=(&CLK_GCC_TEST|0x0D0)
&CLK_TEST_GCC_PDM_XO4_CLK=(&CLK_GCC_TEST|0x0D1)
&CLK_TEST_GCC_PRNG_AHB_CLK=(&CLK_GCC_TEST|0x0D8)
&CLK_TEST_GCC_QDSS_AT_CLK=(&CLK_GCC_TEST|0x042)
&CLK_TEST_GCC_QDSS_CFG_AHB_CLK=(&CLK_GCC_TEST|0x041)
&CLK_TEST_GCC_QDSS_DAP_AHB_CLK=(&CLK_GCC_TEST|0x040)
&CLK_TEST_GCC_QDSS_DAP_CLK=(&CLK_GCC_TEST|0x049)
&CLK_TEST_GCC_QDSS_ETR_USB_CLK=(&CLK_GCC_TEST|0x043)
&CLK_TEST_GCC_QDSS_STM_CLK=(&CLK_GCC_TEST|0x044)
&CLK_TEST_GCC_QDSS_TRACECLKIN_CLK=(&CLK_GCC_TEST|0x045)
&CLK_TEST_GCC_QDSS_TSCTR_DIV16_CLK=(&CLK_GCC_TEST|0x04C)
&CLK_TEST_GCC_QDSS_TSCTR_DIV2_CLK=(&CLK_GCC_TEST|0x046)
&CLK_TEST_GCC_QDSS_TSCTR_DIV3_CLK=(&CLK_GCC_TEST|0x048)
&CLK_TEST_GCC_QDSS_TSCTR_DIV4_CLK=(&CLK_GCC_TEST|0x04A)
&CLK_TEST_GCC_QDSS_TSCTR_DIV8_CLK=(&CLK_GCC_TEST|0x04B)
&CLK_TEST_GCC_QPIC_AHB_CLK=(&CLK_GCC_TEST|0x079)
&CLK_TEST_GCC_QPIC_CLK=(&CLK_GCC_TEST|0x078)
&CLK_TEST_GCC_QPIC_SYSTEM_CLK=(&CLK_GCC_TEST|0x07A)
&CLK_TEST_GCC_RBCPR_AHB_CLK=(&CLK_GCC_TEST|0x191)
&CLK_TEST_GCC_RBCPR_CLK=(&CLK_GCC_TEST|0x190)
&CLK_TEST_GCC_RPM_BUS_AHB_CLK=(&CLK_GCC_TEST|0x11A)
&CLK_TEST_GCC_RPM_PROC_FCLK=(&CLK_GCC_TEST|0x118)
&CLK_TEST_GCC_RPM_PROC_HCLK=(&CLK_GCC_TEST|0x119)
&CLK_TEST_GCC_RPM_SLEEP_CLK=(&CLK_GCC_TEST|0x11B)
&CLK_TEST_GCC_RPM_TIMER_CLK=(&CLK_GCC_TEST|0x11C)
&CLK_TEST_GCC_RPM_CFG_XPU_CLK=(&CLK_GCC_TEST|0x038)
&CLK_TEST_GCC_SDCC1_AHB_CLK=(&CLK_GCC_TEST|0x069)
&CLK_TEST_GCC_SDCC1_APPS_CLK=(&CLK_GCC_TEST|0x068)
&CLK_TEST_GCC_SDCC2_AHB_CLK=(&CLK_GCC_TEST|0x071)
&CLK_TEST_GCC_SDCC2_APPS_CLK=(&CLK_GCC_TEST|0x070)
&CLK_TEST_GCC_APSS_TCU_ASYNC_CLK=(&CLK_GCC_TEST|0x1E9)
&CLK_TEST_GCC_APSS_TCU_CLK=(&CLK_GCC_TEST|0x050)
&CLK_TEST_GCC_GFX_TBU_CLK=(&CLK_GCC_TEST|0x052)
&CLK_TEST_GCC_GFX_TCU_CLK=(&CLK_GCC_TEST|0x053)
&CLK_TEST_GCC_GTCU_AHB_CLK=(&CLK_GCC_TEST|0x058)
&CLK_TEST_GCC_MDP_TBU_CLK=(&CLK_GCC_TEST|0x051)
&CLK_TEST_GCC_MSS_TBU_Q6_AXI_CLK=(&CLK_GCC_TEST|0x057)
&CLK_TEST_GCC_MSS_TBU_AXI_CLK=(&CLK_GCC_TEST|0x055)
&CLK_TEST_GCC_MSS_TBU_GSS_AXI_CLK=(&CLK_GCC_TEST|0x056)
&CLK_TEST_GCC_PCNOC_TBU_CLK=(&CLK_GCC_TEST|0x05D)
&CLK_TEST_GCC_PRONTO_TBU_CLK=(&CLK_GCC_TEST|0x05E)
&CLK_TEST_GCC_SMMU_CATS_CLK=(&CLK_GCC_TEST|0x05F)
&CLK_TEST_GCC_SMMU_CFG_CLK=(&CLK_GCC_TEST|0x05B)
&CLK_TEST_GCC_SMMU_XPU_CLK=(&CLK_GCC_TEST|0x059)
&CLK_TEST_GCC_VENUS_TBU_CLK=(&CLK_GCC_TEST|0x054)
&CLK_TEST_GCC_VFE_TBU_CLK=(&CLK_GCC_TEST|0x05A)
&CLK_TEST_GCC_SNOC_BUS_TIMEOUT0_AHB_CLK=(&CLK_GCC_TEST|0x170)
&CLK_TEST_GCC_SPDM_BIMC_CY_CLK=(&CLK_GCC_TEST|0x133)
&CLK_TEST_GCC_SPDM_CFG_AHB_CLK=(&CLK_GCC_TEST|0x130)
&CLK_TEST_GCC_SPDM_FF_CLK=(&CLK_GCC_TEST|0x132)
&CLK_TEST_GCC_SPDM_MSTR_AHB_CLK=(&CLK_GCC_TEST|0x131)
&CLK_TEST_GCC_SPDM_PCNOC_CY_CLK=(&CLK_GCC_TEST|0x135)
&CLK_TEST_GCC_SPDM_RPM_CY_CLK=(&CLK_GCC_TEST|0x136)
&CLK_TEST_GCC_SPDM_SNOC_CY_CLK=(&CLK_GCC_TEST|0x134)
&CLK_TEST_GCC_ULTAUDIO_AHBFABRIC_EFABRIC_SPDM_CLK=(&CLK_GCC_TEST|0x1B8)
&CLK_TEST_GCC_SPMI_AHB_CLK=(&CLK_GCC_TEST|0x12A)
&CLK_TEST_GCC_SPMI_PCNOC_AHB_CLK=(&CLK_GCC_TEST|0x129)
&CLK_TEST_GCC_SPMI_SER_CLK=(&CLK_GCC_TEST|0x128)
&CLK_TEST_GCC_SEC_CTRL_ACC_CLK=(&CLK_GCC_TEST|0x120)
&CLK_TEST_GCC_SEC_CTRL_AHB_CLK=(&CLK_GCC_TEST|0x121)
&CLK_TEST_GCC_SEC_CTRL_BOOT_ROM_PATCH_CLK=(&CLK_GCC_TEST|0x124)
&CLK_TEST_GCC_SEC_CTRL_CLK=(&CLK_GCC_TEST|0x122)
&CLK_TEST_GCC_SEC_CTRL_SENSE_CLK=(&CLK_GCC_TEST|0x123)
&CLK_TEST_GCC_SNOC_PCNOC_AHB_CLK=(&CLK_GCC_TEST|0x004)
&CLK_TEST_GCC_SYS_NOC_APSS_AHB_CLK=(&CLK_GCC_TEST|0x003)
&CLK_TEST_GCC_SYS_NOC_AT_CLK=(&CLK_GCC_TEST|0x006)
&CLK_TEST_GCC_SYS_NOC_AXI_CLK=(&CLK_GCC_TEST|0x000)
&CLK_TEST_GCC_SYS_NOC_QDSS_STM_AXI_CLK=(&CLK_GCC_TEST|0x002)
&CLK_TEST_GCC_TCSR_AHB_CLK=(&CLK_GCC_TEST|0x0F0)
&CLK_TEST_GCC_TLMM_AHB_CLK=(&CLK_GCC_TEST|0x108)
&CLK_TEST_GCC_TLMM_CLK=(&CLK_GCC_TEST|0x109)
&CLK_TEST_GCC_ULTAUDIO_LPAIF_AUX_I2S_CLK=(&CLK_GCC_TEST|0x1B4)
&CLK_TEST_GCC_ULTAUDIO_EXT_MCLK2_CLK=(&CLK_GCC_TEST|0x1B4)
&CLK_TEST_GCC_ULTAUDIO_PCM_DATA_OE_CLK=(&CLK_GCC_TEST|0x1B4)
&CLK_TEST_GCC_ULTAUDIO_LPAIF_PRI_I2S_CLK=(&CLK_GCC_TEST|0x1B2)
&CLK_TEST_GCC_ULTAUDIO_LPAIF_SEC_I2S_CLK=(&CLK_GCC_TEST|0x1B3)
&CLK_TEST_GCC_USB2A_PHY_SLEEP_CLK=(&CLK_GCC_TEST|0x063)
&CLK_TEST_GCC_USB_HS_PHY_CFG_AHB_CLK=(&CLK_GCC_TEST|0x064)
&CLK_TEST_GCC_USB_HS_AHB_CLK=(&CLK_GCC_TEST|0x061)
&CLK_TEST_GCC_USB_HS_INACTIVITY_TIMERS_CLK=(&CLK_GCC_TEST|0x062)
&CLK_TEST_GCC_USB_HS_SYSTEM_CLK=(&CLK_GCC_TEST|0x060)
&CLK_TEST_GCC_VENUS0_AHB_CLK=(&CLK_GCC_TEST|0x1F3)
&CLK_TEST_GCC_VENUS0_AXI_CLK=(&CLK_GCC_TEST|0x1F2)
&CLK_TEST_GCC_VENUS0_CORE0_VCODEC0_CLK=(&CLK_GCC_TEST|0x0EE)
&CLK_TEST_GCC_VENUS0_QDSS_APB_CLK=(&CLK_GCC_TEST|0x1EF)
&CLK_TEST_GCC_VENUS0_QDSS_AT_CLK=(&CLK_GCC_TEST|0x1F4)
&CLK_TEST_GCC_VENUS0_QDSS_TSCTR_DIV8_CLK=(&CLK_GCC_TEST|0x1F5)
&CLK_TEST_GCC_VENUS0_VCODEC0_CLK=(&CLK_GCC_TEST|0x1F1)
&CLK_TEST_GCC_PCNOC_MPU_CFG_AHB_CLK=(&CLK_GCC_TEST|0x0C9)
&CLK_TEST_GCC_PRNG_XPU_CFG_AHB_CLK=(&CLK_GCC_TEST|0x0C8)

; MSS Test Clocks

; WCSS Test Clocks
&CLK_TEST_WCSS_BT_32M_CLK_SRC=(&CLK_WCSS_TEST|0xD)
&CLK_TEST_WCSS_BT_FM_19M_CLK_SRC=(&CLK_WCSS_TEST|0xE)
&CLK_TEST_WCSS_COMMON_AHB_CLK=(&CLK_WCSS_TEST|0x15)
&CLK_TEST_WCSS_COMMON_BT_32M_CLK=(&CLK_WCSS_TEST|0x18)
&CLK_TEST_WCSS_COMMON_BT_FM_19M_CLK=(&CLK_WCSS_TEST|0x19)
&CLK_TEST_WCSS_COMMON_CPU_CLK=(&CLK_WCSS_TEST|0x14)
&CLK_TEST_WCSS_COMMON_PHY_DBG_CLK=(&CLK_WCSS_TEST|0x17)
&CLK_TEST_WCSS_COMMON_SLP_CLK=(&CLK_WCSS_TEST|0x1A)
&CLK_TEST_WCSS_COMMON_TRC_CLK=(&CLK_WCSS_TEST|0x16)
&CLK_TEST_WCSS_COMMON_XO_CLK=(&CLK_WCSS_TEST|0x1B)
&CLK_TEST_O_WCSS_AHB_S0_CLK=(&CLK_WCSS_TEST|0x27)
&CLK_TEST_O_WCSS_AXI_M_CLK=(&CLK_WCSS_TEST|0x26)
&CLK_TEST_O_WCSS_BUS_TIMEOUT_CLK=(&CLK_WCSS_TEST|0x2A)
&CLK_TEST_WCSS_CPU_AHB_CLK_SRC=(&CLK_WCSS_TEST|0xb)
&CLK_TEST_WCSS_SLP_CLK_SRC=(&CLK_WCSS_TEST|0xF)
&CLK_TEST_WCSS_TOP_AHB_CLK=(&CLK_WCSS_TEST|0x11)
&CLK_TEST_WCSS_TOP_SLP_CLK=(&CLK_WCSS_TEST|0x12)
&CLK_TEST_WCSS_TOP_XO_CLK=(&CLK_WCSS_TEST|0x13)
&CLK_TEST_WCSS_XO_CLK_SRC=(&CLK_WCSS_TEST|0x10)
&CLK_TEST_O_WCSS_ADC_240M_CLK=(&CLK_WCSS_TEST|0x22)
&CLK_TEST_WCSS_DAC_SM_CLK=(&CLK_WCSS_TEST|0x13)
&CLK_TEST_WCSS_RFIF_CLK_SRC=(&CLK_WCSS_TEST|0xA)
&CLK_TEST_WCSS_WLAN_ADC_CLK=(&CLK_WCSS_TEST|0x23)
&CLK_TEST_WCSS_WLAN_AHB_CLK=(&CLK_WCSS_TEST|0x25)
&CLK_TEST_WCSS_WLAN_PHY_DAC_CLK=(&CLK_WCSS_TEST|0x21)
&CLK_TEST_WCSS_WLAN_PHY_DBG_CLK=(&CLK_WCSS_TEST|0x20)
&CLK_TEST_WCSS_WLAN_PHY_MAIN1_FAST_CLK=(&CLK_WCSS_TEST|0x1C)
&CLK_TEST_WCSS_WLAN_RFA_CAL_CLK=(&CLK_WCSS_TEST|0x29)
&CLK_TEST_WCSS_WLAN_RFIF_CLK=(&CLK_WCSS_TEST|0x24)
&CLK_TEST_WLAN_PHY_MAIN1_RX_CLK=(&CLK_WCSS_TEST|0x1E)
&CLK_TEST_WLAN_PHY_MAIN1_TX_CLK=(&CLK_WCSS_TEST|0x1D)
&CLK_TEST_WLAN_PHY_MAIN2_CLK=(&CLK_WCSS_TEST|0x1F)

; APCS Test Clocks
&CLK_TEST_APCS_HDCD_AHBGATED_CLK=(&CLK_APCS_TEST|0x4000)
&CLK_TEST_APCS_IMREF_CLK=(&CLK_APCS_TEST|0x6000)
&CLK_TEST_APCS_IMSLEEP_CLK=(&CLK_APCS_TEST|0x7000)
&CLK_TEST_APCS_L2LEAF_CLK=(&CLK_APCS_TEST|0x1000)
&CLK_TEST_APCS_LEAF0_CLK=(&CLK_APCS_TEST|0x0000)
&CLK_TEST_APCS_LEAF1_CLK=(&CLK_APCS_TEST|0x0100)
&CLK_TEST_APCS_LEAF2_CLK=(&CLK_APCS_TEST|0x0200)
&CLK_TEST_APCS_LEAF3_CLK=(&CLK_APCS_TEST|0x0300)
&CLK_TEST_APCS_SYSQSB_CLK=(&CLK_APCS_TEST|0x3000)

goto Init_Constants_Done



Print_Clock_Help:

  print ""
  print "********************************************************** GCC **********************************************************"
  print ""
  print "[ APSS ]"
  print " apss_gcc_dbg_clk                        gcc_apss_ahb_clk                        gcc_apss_axi_clk                        "
  print ""
  print "[ AUDIO_AHB_BUS ]"
  print " gcc_ultaudio_ahbfabric_ixfabric_clk     gcc_ultaudio_ahbfabric_ixfabric_lpm_clk                                         "
  print ""
  print "[ AUDIO_CORE ]"
  print " gcc_ultaudio_pcnoc_mport_clk            gcc_ultaudio_pcnoc_sway_clk                                                     "
  print ""
  print "[ AUDIO_CXO ]"
  print " gcc_ultaudio_avsync_xo_clk              gcc_ultaudio_stc_xo_clk                                                         "
  print ""
  print "[ AUDIO_DIGCODEC ]"
  print " gcc_codec_digcodec_clk                                                                                                  "
  print ""
  print "[ BIMC ]"
  print " gcc_bimc_apss_axi_clk                   gcc_bimc_at_clk                         gcc_bimc_cfg_ahb_clk                    "
  print " gcc_bimc_clk                            gcc_bimc_gpu_clk                        gcc_bimc_sleep_clk                      "
  print " gcc_bimc_sysnoc_axi_clk                 gcc_bimc_tcu_clk                        gcc_bimc_xo_clk                         "
  print ""
  print "[ BLSP1 ]"
  print " gcc_blsp1_ahb_clk                       gcc_blsp1_sleep_clk                                                             "
  print ""
  print "[ BLSP1_QUP1 ]"
  print " gcc_blsp1_qup1_i2c_apps_clk             gcc_blsp1_qup1_spi_apps_clk                                                     "
  print ""
  print "[ BLSP1_QUP2 ]"
  print " gcc_blsp1_qup2_i2c_apps_clk             gcc_blsp1_qup2_spi_apps_clk                                                     "
  print ""
  print "[ BLSP1_QUP3 ]"
  print " gcc_blsp1_qup3_i2c_apps_clk             gcc_blsp1_qup3_spi_apps_clk                                                     "
  print ""
  print "[ BLSP1_QUP4 ]"
  print " gcc_blsp1_qup4_i2c_apps_clk             gcc_blsp1_qup4_spi_apps_clk                                                     "
  print ""
  print "[ BLSP1_QUP5 ]"
  print " gcc_blsp1_qup5_i2c_apps_clk             gcc_blsp1_qup5_spi_apps_clk                                                     "
  print ""
  print "[ BLSP1_QUP6 ]"
  print " gcc_blsp1_qup6_i2c_apps_clk             gcc_blsp1_qup6_spi_apps_clk                                                     "
  print ""
  print "[ BLSP1_UART1 ]"
  print " gcc_blsp1_uart1_apps_clk                gcc_blsp1_uart1_sim_clk                                                         "
  print ""
  print "[ BLSP1_UART2 ]"
  print " gcc_blsp1_uart2_apps_clk                gcc_blsp1_uart2_sim_clk                                                         "
  print ""
  print "[ BOOT_ROM ]"
  print " gcc_boot_rom_ahb_clk                                                                                                    "
  print ""
  print "[ CAMSS_CSI0 ]"
  print " gcc_camss_csi0_ahb_clk                  gcc_camss_csi0_clk                                                              "
  print ""
  print "[ CAMSS_CSI0PHY ]"
  print " gcc_camss_csi0phy_clk                                                                                                   "
  print ""
  print "[ CAMSS_CSI0PIX ]"
  print " gcc_camss_csi0pix_clk                                                                                                   "
  print ""
  print "[ CAMSS_CSI0RDI ]"
  print " gcc_camss_csi0rdi_clk                                                                                                   "
  print ""
  print "[ CAMSS_CSI1 ]"
  print " gcc_camss_csi1_ahb_clk                  gcc_camss_csi1_clk                                                              "
  print ""
  print "[ CAMSS_CSI1PHY ]"
  print " gcc_camss_csi1phy_clk                                                                                                   "
  print ""
  print "[ CAMSS_CSI1PIX ]"
  print " gcc_camss_csi1pix_clk                                                                                                   "
  print ""
  print "[ CAMSS_CSI1RDI ]"
  print " gcc_camss_csi1rdi_clk                                                                                                   "
  print ""
  print "[ CAMSS_CSI_VFE0 ]"
  print " gcc_camss_csi_vfe0_clk                                                                                                  "
  print ""
  print "[ CAMSS_GP0 ]"
  print " gcc_camss_gp0_clk                                                                                                       "
  print ""
  print "[ CAMSS_GP1 ]"
  print " gcc_camss_gp1_clk                                                                                                       "
  print ""
  print "[ CAMSS_ISPIF ]"
  print " gcc_camss_ispif_ahb_clk                                                                                                 "
  print ""
  print "[ CAMSS_MCLK0 ]"
  print " gcc_camss_mclk0_clk                                                                                                     "
  print ""
  print "[ CAMSS_MCLK1 ]"
  print " gcc_camss_mclk1_clk                                                                                                     "
  print ""
  print "[ CAMSS_PHY0 ]"
  print " gcc_camss_csi0phytimer_clk                                                                                              "
  print ""
  print "[ CAMSS_TOP ]"
  print " gcc_camss_ahb_clk                       gcc_camss_top_ahb_clk                                                           "
  print ""
  print "[ CAMSS_VFE ]"
  print " gcc_camss_vfe0_clk                      gcc_camss_vfe0_vbif_clk                 gcc_camss_vfe_ahb_clk                   "
  print " gcc_camss_vfe_axi_clk                   gcc_camss_vfe_vbif_ahb_clk              gcc_vfe_qdss_at_clk                     "
  print " gcc_vfe_qdss_tsctr_div8_clk                                                                                             "
  print ""
  print "[ CRYPTO ]"
  print " gcc_crypto_ahb_clk                      gcc_crypto_axi_clk                      gcc_crypto_clk                          "
  print ""
  print "[ DCD ]"
  print " gcc_dcd_xo_clk                                                                                                          "
  print ""
  print "[ DDR_DIM_Wrapper ]"
  print " gcc_ddr_dim_cfg_clk                     gcc_ddr_dim_sleep_clk                   gcc_pcnoc_ddr_cfg_clk                   "
  print ""
  print "[ DEHR ]"
  print " gcc_dehr_clk                                                                                                            "
  print ""
  print "[ GCC ]"
  print " gcc_ahb_clk                             gcc_im_sleep_clk                        gcc_xo_clk                              "
  print " gcc_xo_div4_clk                                                                                                         "
  print ""
  print "[ GCC_MM_SPDM ]"
  print " gcc_spdm_ahb_clk                        gcc_spdm_csi0_clk                       gcc_spdm_gfx3d_clk                      "
  print " gcc_spdm_mdp_clk                        gcc_spdm_pclk0_clk                      gcc_spdm_vcodec0_clk                    "
  print " gcc_spdm_vfe0_clk                                                                                                       "
  print ""
  print "[ GP1 ]"
  print " gcc_gp1_clk                                                                                                             "
  print ""
  print "[ GP2 ]"
  print " gcc_gp2_clk                                                                                                             "
  print ""
  print "[ GP3 ]"
  print " gcc_gp3_clk                                                                                                             "
  print ""
  print "[ IMEM ]"
  print " gcc_imem_axi_clk                        gcc_imem_cfg_ahb_clk                                                            "
  print ""
  print "[ MDSS ]"
  print " gcc_mdss_ahb_clk                        gcc_mdss_axi_clk                        gcc_mdss_byte0_clk                      "
  print " gcc_mdss_esc0_clk                       gcc_mdss_mdp_ahb_clk                    gcc_mdss_mdp_clk                        "
  print " gcc_mdss_mdp_dsi_clk                    gcc_mdss_mdp_vbif_clk                   gcc_mdss_pclk0_clk                      "
  print " gcc_mdss_qdss_at_clk                    gcc_mdss_qdss_tsctr_div8_clk            gcc_mdss_vsync_clk                      "
  print ""
  print "[ MPM ]"
  print " gcc_mpm_ahb_clk                                                                                                         "
  print ""
  print "[ MSG_RAM ]"
  print " gcc_msg_ram_ahb_clk                                                                                                     "
  print ""
  print "[ MSS ]"
  print " gcc_mss_cfg_ahb_clk                     gcc_mss_q6_bimc_axi_clk                 mss_gcc_dbg_clk                         "
  print ""
  print "[ NOC_Conf_APU ]"
  print " gcc_noc_conf_xpu_ahb_clk                                                                                                "
  print ""
  print "[ OTHERS ]"
  print " apss_gcc_ringosc_clk                    bimc_pll_dtest                          bimc_pll_lock_det                       "
  print " gpll0_dtest                             gpll0_lock_det                          gpll1_dtest                             "
  print " gpll1_lock_det                          mpm_gcc_temp_sensor_ringosc_clk         usb2_phy_gcc_atest_ulpi_0_clk           "
  print " usb2_phy_gcc_atest_ulpi_1_clk           wcss_gcc_dbg_clk                                                                "
  print ""
  print "[ OXILI ]"
  print " gcc_bimc_gfx_clk                        gcc_oxili_ahb_clk                       gcc_oxili_gfx3d_clk                     "
  print " gcc_oxili_qdss_at_clk                   gcc_oxili_qdss_tsctr_div8_clk                                                   "
  print ""
  print "[ PCNOC ]"
  print " gcc_pcnoc_ahb_clk                       gcc_pcnoc_at_clk                        gcc_pcnoc_rpm_ahb_clk                   "
  print " gcc_pcnoc_tic_clk                                                                                                       "
  print ""
  print "[ PCNOC_BUS_TIMEOUT0 ]"
  print " gcc_pcnoc_bus_timeout0_ahb_clk                                                                                          "
  print ""
  print "[ PCNOC_BUS_TIMEOUT1 ]"
  print " gcc_pcnoc_bus_timeout1_ahb_clk                                                                                          "
  print ""
  print "[ PCNOC_BUS_TIMEOUT2 ]"
  print " gcc_pcnoc_bus_timeout2_ahb_clk                                                                                          "
  print ""
  print "[ PCNOC_BUS_TIMEOUT3 ]"
  print " gcc_pcnoc_bus_timeout3_ahb_clk                                                                                          "
  print ""
  print "[ PCNOC_BUS_TIMEOUT4 ]"
  print " gcc_pcnoc_bus_timeout4_ahb_clk                                                                                          "
  print ""
  print "[ PCNOC_BUS_TIMEOUT5 ]"
  print " gcc_pcnoc_bus_timeout5_ahb_clk                                                                                          "
  print ""
  print "[ PCNOC_BUS_TIMEOUT6 ]"
  print " gcc_pcnoc_bus_timeout6_ahb_clk                                                                                          "
  print ""
  print "[ PCNOC_BUS_TIMEOUT7 ]"
  print " gcc_pcnoc_bus_timeout7_ahb_clk                                                                                          "
  print ""
  print "[ PCNOC_BUS_TIMEOUT8 ]"
  print " gcc_pcnoc_bus_timeout8_ahb_clk                                                                                          "
  print ""
  print "[ PCNOC_BUS_TIMEOUT9 ]"
  print " gcc_pcnoc_bus_timeout9_ahb_clk                                                                                          "
  print ""
  print "[ PDM ]"
  print " gcc_pdm2_clk                            gcc_pdm_ahb_clk                         gcc_pdm_xo4_clk                         "
  print ""
  print "[ PRNG ]"
  print " gcc_prng_ahb_clk                                                                                                        "
  print ""
  print "[ QDSS ]"
  print " gcc_qdss_at_clk                         gcc_qdss_cfg_ahb_clk                    gcc_qdss_dap_ahb_clk                    "
  print " gcc_qdss_dap_clk                        gcc_qdss_etr_usb_clk                    gcc_qdss_stm_clk                        "
  print " gcc_qdss_traceclkin_clk                 gcc_qdss_tsctr_div16_clk                gcc_qdss_tsctr_div2_clk                 "
  print " gcc_qdss_tsctr_div3_clk                 gcc_qdss_tsctr_div4_clk                 gcc_qdss_tsctr_div8_clk                 "
  print ""
  print "[ QPIC ]"
  print " gcc_qpic_ahb_clk                        gcc_qpic_clk                            gcc_qpic_system_clk                     "
  print ""
  print "[ RBCPR ]"
  print " gcc_rbcpr_ahb_clk                       gcc_rbcpr_clk                                                                   "
  print ""
  print "[ RPM ]"
  print " gcc_rpm_bus_ahb_clk                     gcc_rpm_proc_fclk                       gcc_rpm_proc_hclk                       "
  print " gcc_rpm_sleep_clk                       gcc_rpm_timer_clk                                                               "
  print ""
  print "[ RPM_CFG_XPU ]"
  print " gcc_rpm_cfg_xpu_clk                                                                                                     "
  print ""
  print "[ SDCC1 ]"
  print " gcc_sdcc1_ahb_clk                       gcc_sdcc1_apps_clk                                                              "
  print ""
  print "[ SDCC2 ]"
  print " gcc_sdcc2_ahb_clk                       gcc_sdcc2_apps_clk                                                              "
  print ""
  print "[ SMMU ]"
  print " gcc_apss_tcu_async_clk                  gcc_apss_tcu_clk                        gcc_gfx_tbu_clk                         "
  print " gcc_gfx_tcu_clk                         gcc_gtcu_ahb_clk                        gcc_mdp_tbu_clk                         "
  print " gcc_mss_tbu_Q6_axi_clk                  gcc_mss_tbu_axi_clk                     gcc_mss_tbu_gss_axi_clk                 "
  print " gcc_pcnoc_tbu_clk                       gcc_pronto_tbu_clk                      gcc_smmu_cats_clk                       "
  print " gcc_smmu_cfg_clk                        gcc_smmu_xpu_clk                        gcc_venus_tbu_clk                       "
  print " gcc_vfe_tbu_clk                                                                                                         "
  print ""
  print "[ SNOC_BUS_TIMEOUT0 ]"
  print " gcc_snoc_bus_timeout0_ahb_clk                                                                                           "
  print ""
  print "[ SPDM ]"
  print " gcc_spdm_bimc_cy_clk                    gcc_spdm_cfg_ahb_clk                    gcc_spdm_ff_clk                         "
  print " gcc_spdm_mstr_ahb_clk                   gcc_spdm_pcnoc_cy_clk                   gcc_spdm_rpm_cy_clk                     "
  print " gcc_spdm_snoc_cy_clk                    gcc_ultaudio_ahbfabric_efabric_spdm_clk                                         "
  print ""
  print "[ SPMI ]"
  print " gcc_spmi_ahb_clk                        gcc_spmi_pcnoc_ahb_clk                  gcc_spmi_ser_clk                        "
  print ""
  print "[ Sec_ctrl ]"
  print " gcc_sec_ctrl_acc_clk                    gcc_sec_ctrl_ahb_clk                    gcc_sec_ctrl_boot_rom_patch_clk         "
  print " gcc_sec_ctrl_clk                        gcc_sec_ctrl_sense_clk                                                          "
  print ""
  print "[ System_NOC ]"
  print " gcc_snoc_pcnoc_ahb_clk                  gcc_sys_noc_apss_ahb_clk                gcc_sys_noc_at_clk                      "
  print " gcc_sys_noc_axi_clk                     gcc_sys_noc_qdss_stm_axi_clk                                                    "
  print ""
  print "[ TCSR ]"
  print " gcc_tcsr_ahb_clk                                                                                                        "
  print ""
  print "[ TLMM ]"
  print " gcc_tlmm_ahb_clk                        gcc_tlmm_clk                                                                    "
  print ""
  print "[ ULTAUDIO_AUX_I2S ]"
  print " gcc_ultaudio_lpaif_aux_i2s_clk                                                                                          "
  print ""
  print "[ ULTAUDIO_EXT_MCLK2 ]"
  print " gcc_ultaudio_ext_mclk2_clk                                                                                              "
  print ""
  print "[ ULTAUDIO_PCM_DATA_OE ]"
  print " gcc_ultaudio_pcm_data_oe_clk                                                                                            "
  print ""
  print "[ ULTAUDIO_PRI_I2S ]"
  print " gcc_ultaudio_lpaif_pri_i2s_clk                                                                                          "
  print ""
  print "[ ULTAUDIO_SEC_I2S ]"
  print " gcc_ultaudio_lpaif_sec_i2s_clk                                                                                          "
  print ""
  print "[ USB2A_PHY ]"
  print " gcc_usb2a_phy_sleep_clk                 gcc_usb_hs_phy_cfg_ahb_clk                                                      "
  print ""
  print "[ USB_HS ]"
  print " gcc_usb_hs_ahb_clk                      gcc_usb_hs_inactivity_timers_clk        gcc_usb_hs_system_clk                   "
  print ""
  print "[ VENUS0 ]"
  print " gcc_venus0_ahb_clk                      gcc_venus0_axi_clk                      gcc_venus0_core0_vcodec0_clk            "
  print " gcc_venus0_qdss_apb_clk                 gcc_venus0_qdss_at_clk                  gcc_venus0_qdss_tsctr_div8_clk          "
  print " gcc_venus0_vcodec0_clk                                                                                                  "
  print ""
  print "[ pcnoc_mpu ]"
  print " gcc_pcnoc_mpu_cfg_ahb_clk                                                                                               "
  print ""
  print "[ prng_xpu ]"
  print " gcc_prng_xpu_cfg_ahb_clk                                                                                                "
  print ""
  print "********************************************************** WCSS *********************************************************"
  print ""
  print "[ common_ss ]"
  print " wcss_bt_32m_clk_src                     wcss_bt_fm_19m_clk_src                  wcss_common_ahb_clk                     "
  print " wcss_common_bt_32m_clk                  wcss_common_bt_fm_19m_clk               wcss_common_cpu_clk                     "
  print " wcss_common_phy_dbg_clk                 wcss_common_slp_clk                     wcss_common_trc_clk                     "
  print " wcss_common_xo_clk                                                                                                      "
  print ""
  print "[ top ]"
  print " o_wcss_ahb_s0_clk                       o_wcss_axi_m_clk                        o_wcss_bus_timeout_clk                  "
  print " wcss_cpu_ahb_clk_src                    wcss_slp_clk_src                        wcss_top_ahb_clk                        "
  print " wcss_top_slp_clk                        wcss_top_xo_clk                         wcss_xo_clk_src                         "
  print ""
  print "[ wlan ]"
  print " o_wcss_adc_240m_clk                     wcss_dac_sm_clk                         wcss_rfif_clk_src                       "
  print " wcss_wlan_adc_clk                       wcss_wlan_ahb_clk                       wcss_wlan_phy_dac_clk                   "
  print " wcss_wlan_phy_dbg_clk                   wcss_wlan_phy_main1_fast_clk            wcss_wlan_rfa_cal_clk                   "
  print " wcss_wlan_rfif_clk                      wlan_phy_main1_rx_clk                   wlan_phy_main1_tx_clk                   "
  print " wlan_phy_main2_clk                                                                                                      "
  print ""
  print "********************************************************** APCS *********************************************************"
  print ""
  print "[ APCS ]"
  print " apcs_hdcd_ahbgated_clk                  apcs_imref_clk                          apcs_imsleep_clk                        "
  print " apcs_l2leaf_clk                         apcs_leaf0_clk                          apcs_leaf1_clk                          "
  print " apcs_leaf2_clk                          apcs_leaf3_clk                          apcs_sysqsb_clk                         "


  return
  


Print_All:


  gosub Find_Print_Clock apss_gcc_dbg_clk
  gosub Find_Print_Clock gcc_apss_ahb_clk
  gosub Find_Print_Clock gcc_apss_axi_clk
  gosub Find_Print_Clock gcc_ultaudio_ahbfabric_ixfabric_clk
  gosub Find_Print_Clock gcc_ultaudio_ahbfabric_ixfabric_lpm_clk
  gosub Find_Print_Clock gcc_ultaudio_pcnoc_mport_clk
  gosub Find_Print_Clock gcc_ultaudio_pcnoc_sway_clk
  gosub Find_Print_Clock gcc_ultaudio_avsync_xo_clk
  gosub Find_Print_Clock gcc_ultaudio_stc_xo_clk
  gosub Find_Print_Clock gcc_codec_digcodec_clk
  gosub Find_Print_Clock gcc_bimc_apss_axi_clk
  gosub Find_Print_Clock gcc_bimc_at_clk
  gosub Find_Print_Clock gcc_bimc_cfg_ahb_clk
  gosub Find_Print_Clock gcc_bimc_clk
  gosub Find_Print_Clock gcc_bimc_gpu_clk
  gosub Find_Print_Clock gcc_bimc_sleep_clk
  gosub Find_Print_Clock gcc_bimc_sysnoc_axi_clk
  gosub Find_Print_Clock gcc_bimc_tcu_clk
  gosub Find_Print_Clock gcc_bimc_xo_clk
  gosub Find_Print_Clock gcc_blsp1_ahb_clk
  gosub Find_Print_Clock gcc_blsp1_sleep_clk
  gosub Find_Print_Clock gcc_blsp1_qup1_i2c_apps_clk
  gosub Find_Print_Clock gcc_blsp1_qup1_spi_apps_clk
  gosub Find_Print_Clock gcc_blsp1_qup2_i2c_apps_clk
  gosub Find_Print_Clock gcc_blsp1_qup2_spi_apps_clk
  gosub Find_Print_Clock gcc_blsp1_qup3_i2c_apps_clk
  gosub Find_Print_Clock gcc_blsp1_qup3_spi_apps_clk
  gosub Find_Print_Clock gcc_blsp1_qup4_i2c_apps_clk
  gosub Find_Print_Clock gcc_blsp1_qup4_spi_apps_clk
  gosub Find_Print_Clock gcc_blsp1_qup5_i2c_apps_clk
  gosub Find_Print_Clock gcc_blsp1_qup5_spi_apps_clk
  gosub Find_Print_Clock gcc_blsp1_qup6_i2c_apps_clk
  gosub Find_Print_Clock gcc_blsp1_qup6_spi_apps_clk
  gosub Find_Print_Clock gcc_blsp1_uart1_apps_clk
  gosub Find_Print_Clock gcc_blsp1_uart1_sim_clk
  gosub Find_Print_Clock gcc_blsp1_uart2_apps_clk
  gosub Find_Print_Clock gcc_blsp1_uart2_sim_clk
  gosub Find_Print_Clock gcc_boot_rom_ahb_clk
  gosub Find_Print_Clock gcc_camss_csi0_ahb_clk
  gosub Find_Print_Clock gcc_camss_csi0_clk
  gosub Find_Print_Clock gcc_camss_csi0phy_clk
  gosub Find_Print_Clock gcc_camss_csi0pix_clk
  gosub Find_Print_Clock gcc_camss_csi0rdi_clk
  gosub Find_Print_Clock gcc_camss_csi1_ahb_clk
  gosub Find_Print_Clock gcc_camss_csi1_clk
  gosub Find_Print_Clock gcc_camss_csi1phy_clk
  gosub Find_Print_Clock gcc_camss_csi1pix_clk
  gosub Find_Print_Clock gcc_camss_csi1rdi_clk
  gosub Find_Print_Clock gcc_camss_csi_vfe0_clk
  gosub Find_Print_Clock gcc_camss_gp0_clk
  gosub Find_Print_Clock gcc_camss_gp1_clk
  gosub Find_Print_Clock gcc_camss_ispif_ahb_clk
  gosub Find_Print_Clock gcc_camss_mclk0_clk
  gosub Find_Print_Clock gcc_camss_mclk1_clk
  gosub Find_Print_Clock gcc_camss_csi0phytimer_clk
  gosub Find_Print_Clock gcc_camss_ahb_clk
  gosub Find_Print_Clock gcc_camss_top_ahb_clk
  gosub Find_Print_Clock gcc_camss_vfe0_clk
  gosub Find_Print_Clock gcc_camss_vfe0_vbif_clk
  gosub Find_Print_Clock gcc_camss_vfe_ahb_clk
  gosub Find_Print_Clock gcc_camss_vfe_axi_clk
  gosub Find_Print_Clock gcc_camss_vfe_vbif_ahb_clk
  gosub Find_Print_Clock gcc_vfe_qdss_at_clk
  gosub Find_Print_Clock gcc_vfe_qdss_tsctr_div8_clk
  gosub Find_Print_Clock gcc_crypto_ahb_clk
  gosub Find_Print_Clock gcc_crypto_axi_clk
  gosub Find_Print_Clock gcc_crypto_clk
  gosub Find_Print_Clock gcc_dcd_xo_clk
  gosub Find_Print_Clock gcc_ddr_dim_cfg_clk
  gosub Find_Print_Clock gcc_ddr_dim_sleep_clk
  gosub Find_Print_Clock gcc_pcnoc_ddr_cfg_clk
  gosub Find_Print_Clock gcc_dehr_clk
  gosub Find_Print_Clock gcc_ahb_clk
  gosub Find_Print_Clock gcc_im_sleep_clk
  gosub Find_Print_Clock gcc_xo_clk
  gosub Find_Print_Clock gcc_xo_div4_clk
  gosub Find_Print_Clock gcc_spdm_ahb_clk
  gosub Find_Print_Clock gcc_spdm_csi0_clk
  gosub Find_Print_Clock gcc_spdm_gfx3d_clk
  gosub Find_Print_Clock gcc_spdm_mdp_clk
  gosub Find_Print_Clock gcc_spdm_pclk0_clk
  gosub Find_Print_Clock gcc_spdm_vcodec0_clk
  gosub Find_Print_Clock gcc_spdm_vfe0_clk
  gosub Find_Print_Clock gcc_gp1_clk
  gosub Find_Print_Clock gcc_gp2_clk
  gosub Find_Print_Clock gcc_gp3_clk
  gosub Find_Print_Clock gcc_imem_axi_clk
  gosub Find_Print_Clock gcc_imem_cfg_ahb_clk
  gosub Find_Print_Clock gcc_mdss_ahb_clk
  gosub Find_Print_Clock gcc_mdss_axi_clk
  gosub Find_Print_Clock gcc_mdss_byte0_clk
  gosub Find_Print_Clock gcc_mdss_esc0_clk
  gosub Find_Print_Clock gcc_mdss_mdp_ahb_clk
  gosub Find_Print_Clock gcc_mdss_mdp_clk
  gosub Find_Print_Clock gcc_mdss_mdp_dsi_clk
  gosub Find_Print_Clock gcc_mdss_mdp_vbif_clk
  gosub Find_Print_Clock gcc_mdss_pclk0_clk
  gosub Find_Print_Clock gcc_mdss_qdss_at_clk
  gosub Find_Print_Clock gcc_mdss_qdss_tsctr_div8_clk
  gosub Find_Print_Clock gcc_mdss_vsync_clk
  gosub Find_Print_Clock gcc_mpm_ahb_clk
  gosub Find_Print_Clock gcc_msg_ram_ahb_clk
  gosub Find_Print_Clock gcc_mss_cfg_ahb_clk
  gosub Find_Print_Clock gcc_mss_q6_bimc_axi_clk
  gosub Find_Print_Clock mss_gcc_dbg_clk
  gosub Find_Print_Clock gcc_noc_conf_xpu_ahb_clk
  gosub Find_Print_Clock apss_gcc_ringosc_clk
  gosub Find_Print_Clock bimc_pll_dtest
  gosub Find_Print_Clock bimc_pll_lock_det
  gosub Find_Print_Clock gpll0_dtest
  gosub Find_Print_Clock gpll0_lock_det
  gosub Find_Print_Clock gpll1_dtest
  gosub Find_Print_Clock gpll1_lock_det
  gosub Find_Print_Clock mpm_gcc_temp_sensor_ringosc_clk
  gosub Find_Print_Clock usb2_phy_gcc_atest_ulpi_0_clk
  gosub Find_Print_Clock usb2_phy_gcc_atest_ulpi_1_clk
  gosub Find_Print_Clock wcss_gcc_dbg_clk
  gosub Find_Print_Clock gcc_bimc_gfx_clk
  gosub Find_Print_Clock gcc_oxili_ahb_clk
  gosub Find_Print_Clock gcc_oxili_gfx3d_clk
  gosub Find_Print_Clock gcc_oxili_qdss_at_clk
  gosub Find_Print_Clock gcc_oxili_qdss_tsctr_div8_clk
  gosub Find_Print_Clock gcc_pcnoc_ahb_clk
  gosub Find_Print_Clock gcc_pcnoc_at_clk
  gosub Find_Print_Clock gcc_pcnoc_rpm_ahb_clk
  gosub Find_Print_Clock gcc_pcnoc_tic_clk
  gosub Find_Print_Clock gcc_pcnoc_bus_timeout0_ahb_clk
  gosub Find_Print_Clock gcc_pcnoc_bus_timeout1_ahb_clk
  gosub Find_Print_Clock gcc_pcnoc_bus_timeout2_ahb_clk
  gosub Find_Print_Clock gcc_pcnoc_bus_timeout3_ahb_clk
  gosub Find_Print_Clock gcc_pcnoc_bus_timeout4_ahb_clk
  gosub Find_Print_Clock gcc_pcnoc_bus_timeout5_ahb_clk
  gosub Find_Print_Clock gcc_pcnoc_bus_timeout6_ahb_clk
  gosub Find_Print_Clock gcc_pcnoc_bus_timeout7_ahb_clk
  gosub Find_Print_Clock gcc_pcnoc_bus_timeout8_ahb_clk
  gosub Find_Print_Clock gcc_pcnoc_bus_timeout9_ahb_clk
  gosub Find_Print_Clock gcc_pdm2_clk
  gosub Find_Print_Clock gcc_pdm_ahb_clk
  gosub Find_Print_Clock gcc_pdm_xo4_clk
  gosub Find_Print_Clock gcc_prng_ahb_clk
  gosub Find_Print_Clock gcc_qdss_at_clk
  gosub Find_Print_Clock gcc_qdss_cfg_ahb_clk
  gosub Find_Print_Clock gcc_qdss_dap_ahb_clk
  gosub Find_Print_Clock gcc_qdss_dap_clk
  gosub Find_Print_Clock gcc_qdss_etr_usb_clk
  gosub Find_Print_Clock gcc_qdss_stm_clk
  gosub Find_Print_Clock gcc_qdss_traceclkin_clk
  gosub Find_Print_Clock gcc_qdss_tsctr_div16_clk
  gosub Find_Print_Clock gcc_qdss_tsctr_div2_clk
  gosub Find_Print_Clock gcc_qdss_tsctr_div3_clk
  gosub Find_Print_Clock gcc_qdss_tsctr_div4_clk
  gosub Find_Print_Clock gcc_qdss_tsctr_div8_clk
  gosub Find_Print_Clock gcc_qpic_ahb_clk
  gosub Find_Print_Clock gcc_qpic_clk
  gosub Find_Print_Clock gcc_qpic_system_clk
  gosub Find_Print_Clock gcc_rbcpr_ahb_clk
  gosub Find_Print_Clock gcc_rbcpr_clk
  gosub Find_Print_Clock gcc_rpm_bus_ahb_clk
  gosub Find_Print_Clock gcc_rpm_proc_fclk
  gosub Find_Print_Clock gcc_rpm_proc_hclk
  gosub Find_Print_Clock gcc_rpm_sleep_clk
  gosub Find_Print_Clock gcc_rpm_timer_clk
  gosub Find_Print_Clock gcc_rpm_cfg_xpu_clk
  gosub Find_Print_Clock gcc_sdcc1_ahb_clk
  gosub Find_Print_Clock gcc_sdcc1_apps_clk
  gosub Find_Print_Clock gcc_sdcc2_ahb_clk
  gosub Find_Print_Clock gcc_sdcc2_apps_clk
  gosub Find_Print_Clock gcc_apss_tcu_async_clk
  gosub Find_Print_Clock gcc_apss_tcu_clk
  gosub Find_Print_Clock gcc_gfx_tbu_clk
  gosub Find_Print_Clock gcc_gfx_tcu_clk
  gosub Find_Print_Clock gcc_gtcu_ahb_clk
  gosub Find_Print_Clock gcc_mdp_tbu_clk
  gosub Find_Print_Clock gcc_mss_tbu_Q6_axi_clk
  gosub Find_Print_Clock gcc_mss_tbu_axi_clk
  gosub Find_Print_Clock gcc_mss_tbu_gss_axi_clk
  gosub Find_Print_Clock gcc_pcnoc_tbu_clk
  gosub Find_Print_Clock gcc_pronto_tbu_clk
  gosub Find_Print_Clock gcc_smmu_cats_clk
  gosub Find_Print_Clock gcc_smmu_cfg_clk
  gosub Find_Print_Clock gcc_smmu_xpu_clk
  gosub Find_Print_Clock gcc_venus_tbu_clk
  gosub Find_Print_Clock gcc_vfe_tbu_clk
  gosub Find_Print_Clock gcc_snoc_bus_timeout0_ahb_clk
  gosub Find_Print_Clock gcc_spdm_bimc_cy_clk
  gosub Find_Print_Clock gcc_spdm_cfg_ahb_clk
  gosub Find_Print_Clock gcc_spdm_ff_clk
  gosub Find_Print_Clock gcc_spdm_mstr_ahb_clk
  gosub Find_Print_Clock gcc_spdm_pcnoc_cy_clk
  gosub Find_Print_Clock gcc_spdm_rpm_cy_clk
  gosub Find_Print_Clock gcc_spdm_snoc_cy_clk
  gosub Find_Print_Clock gcc_ultaudio_ahbfabric_efabric_spdm_clk
  gosub Find_Print_Clock gcc_spmi_ahb_clk
  gosub Find_Print_Clock gcc_spmi_pcnoc_ahb_clk
  gosub Find_Print_Clock gcc_spmi_ser_clk
  gosub Find_Print_Clock gcc_sec_ctrl_acc_clk
  gosub Find_Print_Clock gcc_sec_ctrl_ahb_clk
  gosub Find_Print_Clock gcc_sec_ctrl_boot_rom_patch_clk
  gosub Find_Print_Clock gcc_sec_ctrl_clk
  gosub Find_Print_Clock gcc_sec_ctrl_sense_clk
  gosub Find_Print_Clock gcc_snoc_pcnoc_ahb_clk
  gosub Find_Print_Clock gcc_sys_noc_apss_ahb_clk
  gosub Find_Print_Clock gcc_sys_noc_at_clk
  gosub Find_Print_Clock gcc_sys_noc_axi_clk
  gosub Find_Print_Clock gcc_sys_noc_qdss_stm_axi_clk
  gosub Find_Print_Clock gcc_tcsr_ahb_clk
  gosub Find_Print_Clock gcc_tlmm_ahb_clk
  gosub Find_Print_Clock gcc_tlmm_clk
  gosub Find_Print_Clock gcc_ultaudio_lpaif_aux_i2s_clk
  gosub Find_Print_Clock gcc_ultaudio_ext_mclk2_clk
  gosub Find_Print_Clock gcc_ultaudio_pcm_data_oe_clk
  gosub Find_Print_Clock gcc_ultaudio_lpaif_pri_i2s_clk
  gosub Find_Print_Clock gcc_ultaudio_lpaif_sec_i2s_clk
  gosub Find_Print_Clock gcc_usb2a_phy_sleep_clk
  gosub Find_Print_Clock gcc_usb_hs_phy_cfg_ahb_clk
  gosub Find_Print_Clock gcc_usb_hs_ahb_clk
  gosub Find_Print_Clock gcc_usb_hs_inactivity_timers_clk
  gosub Find_Print_Clock gcc_usb_hs_system_clk
  gosub Find_Print_Clock gcc_venus0_ahb_clk
  gosub Find_Print_Clock gcc_venus0_axi_clk
  gosub Find_Print_Clock gcc_venus0_core0_vcodec0_clk
  gosub Find_Print_Clock gcc_venus0_qdss_apb_clk
  gosub Find_Print_Clock gcc_venus0_qdss_at_clk
  gosub Find_Print_Clock gcc_venus0_qdss_tsctr_div8_clk
  gosub Find_Print_Clock gcc_venus0_vcodec0_clk
  gosub Find_Print_Clock gcc_pcnoc_mpu_cfg_ahb_clk
  gosub Find_Print_Clock gcc_prng_xpu_cfg_ahb_clk
  gosub Find_Print_Clock wcss_bt_32m_clk_src
  gosub Find_Print_Clock wcss_bt_fm_19m_clk_src
  gosub Find_Print_Clock wcss_common_ahb_clk
  gosub Find_Print_Clock wcss_common_bt_32m_clk
  gosub Find_Print_Clock wcss_common_bt_fm_19m_clk
  gosub Find_Print_Clock wcss_common_cpu_clk
  gosub Find_Print_Clock wcss_common_phy_dbg_clk
  gosub Find_Print_Clock wcss_common_slp_clk
  gosub Find_Print_Clock wcss_common_trc_clk
  gosub Find_Print_Clock wcss_common_xo_clk
  gosub Find_Print_Clock o_wcss_ahb_s0_clk
  gosub Find_Print_Clock o_wcss_axi_m_clk
  gosub Find_Print_Clock o_wcss_bus_timeout_clk
  gosub Find_Print_Clock wcss_cpu_ahb_clk_src
  gosub Find_Print_Clock wcss_slp_clk_src
  gosub Find_Print_Clock wcss_top_ahb_clk
  gosub Find_Print_Clock wcss_top_slp_clk
  gosub Find_Print_Clock wcss_top_xo_clk
  gosub Find_Print_Clock wcss_xo_clk_src
  gosub Find_Print_Clock o_wcss_adc_240m_clk
  gosub Find_Print_Clock wcss_dac_sm_clk
  gosub Find_Print_Clock wcss_rfif_clk_src
  gosub Find_Print_Clock wcss_wlan_adc_clk
  gosub Find_Print_Clock wcss_wlan_ahb_clk
  gosub Find_Print_Clock wcss_wlan_phy_dac_clk
  gosub Find_Print_Clock wcss_wlan_phy_dbg_clk
  gosub Find_Print_Clock wcss_wlan_phy_main1_fast_clk
  gosub Find_Print_Clock wcss_wlan_rfa_cal_clk
  gosub Find_Print_Clock wcss_wlan_rfif_clk
  gosub Find_Print_Clock wlan_phy_main1_rx_clk
  gosub Find_Print_Clock wlan_phy_main1_tx_clk
  gosub Find_Print_Clock wlan_phy_main2_clk
  gosub Find_Print_Clock apcs_hdcd_ahbgated_clk
  gosub Find_Print_Clock apcs_imref_clk
  gosub Find_Print_Clock apcs_imsleep_clk
  gosub Find_Print_Clock apcs_l2leaf_clk
  gosub Find_Print_Clock apcs_leaf0_clk
  gosub Find_Print_Clock apcs_leaf1_clk
  gosub Find_Print_Clock apcs_leaf2_clk
  gosub Find_Print_Clock apcs_leaf3_clk
  gosub Find_Print_Clock apcs_sysqsb_clk

  return
  


Print_All_SS:

  if ("&choice"=="gcc_all")
  (
    gosub Find_Print_Clock apss_gcc_dbg_clk
    gosub Find_Print_Clock gcc_apss_ahb_clk
    gosub Find_Print_Clock gcc_apss_axi_clk
    gosub Find_Print_Clock gcc_ultaudio_ahbfabric_ixfabric_clk
    gosub Find_Print_Clock gcc_ultaudio_ahbfabric_ixfabric_lpm_clk
    gosub Find_Print_Clock gcc_ultaudio_pcnoc_mport_clk
    gosub Find_Print_Clock gcc_ultaudio_pcnoc_sway_clk
    gosub Find_Print_Clock gcc_ultaudio_avsync_xo_clk
    gosub Find_Print_Clock gcc_ultaudio_stc_xo_clk
    gosub Find_Print_Clock gcc_codec_digcodec_clk
    gosub Find_Print_Clock gcc_bimc_apss_axi_clk
    gosub Find_Print_Clock gcc_bimc_at_clk
    gosub Find_Print_Clock gcc_bimc_cfg_ahb_clk
    gosub Find_Print_Clock gcc_bimc_clk
    gosub Find_Print_Clock gcc_bimc_gpu_clk
    gosub Find_Print_Clock gcc_bimc_sleep_clk
    gosub Find_Print_Clock gcc_bimc_sysnoc_axi_clk
    gosub Find_Print_Clock gcc_bimc_tcu_clk
    gosub Find_Print_Clock gcc_bimc_xo_clk
    gosub Find_Print_Clock gcc_blsp1_ahb_clk
    gosub Find_Print_Clock gcc_blsp1_sleep_clk
    gosub Find_Print_Clock gcc_blsp1_qup1_i2c_apps_clk
    gosub Find_Print_Clock gcc_blsp1_qup1_spi_apps_clk
    gosub Find_Print_Clock gcc_blsp1_qup2_i2c_apps_clk
    gosub Find_Print_Clock gcc_blsp1_qup2_spi_apps_clk
    gosub Find_Print_Clock gcc_blsp1_qup3_i2c_apps_clk
    gosub Find_Print_Clock gcc_blsp1_qup3_spi_apps_clk
    gosub Find_Print_Clock gcc_blsp1_qup4_i2c_apps_clk
    gosub Find_Print_Clock gcc_blsp1_qup4_spi_apps_clk
    gosub Find_Print_Clock gcc_blsp1_qup5_i2c_apps_clk
    gosub Find_Print_Clock gcc_blsp1_qup5_spi_apps_clk
    gosub Find_Print_Clock gcc_blsp1_qup6_i2c_apps_clk
    gosub Find_Print_Clock gcc_blsp1_qup6_spi_apps_clk
    gosub Find_Print_Clock gcc_blsp1_uart1_apps_clk
    gosub Find_Print_Clock gcc_blsp1_uart1_sim_clk
    gosub Find_Print_Clock gcc_blsp1_uart2_apps_clk
    gosub Find_Print_Clock gcc_blsp1_uart2_sim_clk
    gosub Find_Print_Clock gcc_boot_rom_ahb_clk
    gosub Find_Print_Clock gcc_camss_csi0_ahb_clk
    gosub Find_Print_Clock gcc_camss_csi0_clk
    gosub Find_Print_Clock gcc_camss_csi0phy_clk
    gosub Find_Print_Clock gcc_camss_csi0pix_clk
    gosub Find_Print_Clock gcc_camss_csi0rdi_clk
    gosub Find_Print_Clock gcc_camss_csi1_ahb_clk
    gosub Find_Print_Clock gcc_camss_csi1_clk
    gosub Find_Print_Clock gcc_camss_csi1phy_clk
    gosub Find_Print_Clock gcc_camss_csi1pix_clk
    gosub Find_Print_Clock gcc_camss_csi1rdi_clk
    gosub Find_Print_Clock gcc_camss_csi_vfe0_clk
    gosub Find_Print_Clock gcc_camss_gp0_clk
    gosub Find_Print_Clock gcc_camss_gp1_clk
    gosub Find_Print_Clock gcc_camss_ispif_ahb_clk
    gosub Find_Print_Clock gcc_camss_mclk0_clk
    gosub Find_Print_Clock gcc_camss_mclk1_clk
    gosub Find_Print_Clock gcc_camss_csi0phytimer_clk
    gosub Find_Print_Clock gcc_camss_ahb_clk
    gosub Find_Print_Clock gcc_camss_top_ahb_clk
    gosub Find_Print_Clock gcc_camss_vfe0_clk
    gosub Find_Print_Clock gcc_camss_vfe0_vbif_clk
    gosub Find_Print_Clock gcc_camss_vfe_ahb_clk
    gosub Find_Print_Clock gcc_camss_vfe_axi_clk
    gosub Find_Print_Clock gcc_camss_vfe_vbif_ahb_clk
    gosub Find_Print_Clock gcc_vfe_qdss_at_clk
    gosub Find_Print_Clock gcc_vfe_qdss_tsctr_div8_clk
    gosub Find_Print_Clock gcc_crypto_ahb_clk
    gosub Find_Print_Clock gcc_crypto_axi_clk
    gosub Find_Print_Clock gcc_crypto_clk
    gosub Find_Print_Clock gcc_dcd_xo_clk
    gosub Find_Print_Clock gcc_ddr_dim_cfg_clk
    gosub Find_Print_Clock gcc_ddr_dim_sleep_clk
    gosub Find_Print_Clock gcc_pcnoc_ddr_cfg_clk
    gosub Find_Print_Clock gcc_dehr_clk
    gosub Find_Print_Clock gcc_ahb_clk
    gosub Find_Print_Clock gcc_im_sleep_clk
    gosub Find_Print_Clock gcc_xo_clk
    gosub Find_Print_Clock gcc_xo_div4_clk
    gosub Find_Print_Clock gcc_spdm_ahb_clk
    gosub Find_Print_Clock gcc_spdm_csi0_clk
    gosub Find_Print_Clock gcc_spdm_gfx3d_clk
    gosub Find_Print_Clock gcc_spdm_mdp_clk
    gosub Find_Print_Clock gcc_spdm_pclk0_clk
    gosub Find_Print_Clock gcc_spdm_vcodec0_clk
    gosub Find_Print_Clock gcc_spdm_vfe0_clk
    gosub Find_Print_Clock gcc_gp1_clk
    gosub Find_Print_Clock gcc_gp2_clk
    gosub Find_Print_Clock gcc_gp3_clk
    gosub Find_Print_Clock gcc_imem_axi_clk
    gosub Find_Print_Clock gcc_imem_cfg_ahb_clk
    gosub Find_Print_Clock gcc_mdss_ahb_clk
    gosub Find_Print_Clock gcc_mdss_axi_clk
    gosub Find_Print_Clock gcc_mdss_byte0_clk
    gosub Find_Print_Clock gcc_mdss_esc0_clk
    gosub Find_Print_Clock gcc_mdss_mdp_ahb_clk
    gosub Find_Print_Clock gcc_mdss_mdp_clk
    gosub Find_Print_Clock gcc_mdss_mdp_dsi_clk
    gosub Find_Print_Clock gcc_mdss_mdp_vbif_clk
    gosub Find_Print_Clock gcc_mdss_pclk0_clk
    gosub Find_Print_Clock gcc_mdss_qdss_at_clk
    gosub Find_Print_Clock gcc_mdss_qdss_tsctr_div8_clk
    gosub Find_Print_Clock gcc_mdss_vsync_clk
    gosub Find_Print_Clock gcc_mpm_ahb_clk
    gosub Find_Print_Clock gcc_msg_ram_ahb_clk
    gosub Find_Print_Clock gcc_mss_cfg_ahb_clk
    gosub Find_Print_Clock gcc_mss_q6_bimc_axi_clk
    gosub Find_Print_Clock mss_gcc_dbg_clk
    gosub Find_Print_Clock gcc_noc_conf_xpu_ahb_clk
    gosub Find_Print_Clock apss_gcc_ringosc_clk
    gosub Find_Print_Clock bimc_pll_dtest
    gosub Find_Print_Clock bimc_pll_lock_det
    gosub Find_Print_Clock gpll0_dtest
    gosub Find_Print_Clock gpll0_lock_det
    gosub Find_Print_Clock gpll1_dtest
    gosub Find_Print_Clock gpll1_lock_det
    gosub Find_Print_Clock mpm_gcc_temp_sensor_ringosc_clk
    gosub Find_Print_Clock usb2_phy_gcc_atest_ulpi_0_clk
    gosub Find_Print_Clock usb2_phy_gcc_atest_ulpi_1_clk
    gosub Find_Print_Clock wcss_gcc_dbg_clk
    gosub Find_Print_Clock gcc_bimc_gfx_clk
    gosub Find_Print_Clock gcc_oxili_ahb_clk
    gosub Find_Print_Clock gcc_oxili_gfx3d_clk
    gosub Find_Print_Clock gcc_oxili_qdss_at_clk
    gosub Find_Print_Clock gcc_oxili_qdss_tsctr_div8_clk
    gosub Find_Print_Clock gcc_pcnoc_ahb_clk
    gosub Find_Print_Clock gcc_pcnoc_at_clk
    gosub Find_Print_Clock gcc_pcnoc_rpm_ahb_clk
    gosub Find_Print_Clock gcc_pcnoc_tic_clk
    gosub Find_Print_Clock gcc_pcnoc_bus_timeout0_ahb_clk
    gosub Find_Print_Clock gcc_pcnoc_bus_timeout1_ahb_clk
    gosub Find_Print_Clock gcc_pcnoc_bus_timeout2_ahb_clk
    gosub Find_Print_Clock gcc_pcnoc_bus_timeout3_ahb_clk
    gosub Find_Print_Clock gcc_pcnoc_bus_timeout4_ahb_clk
    gosub Find_Print_Clock gcc_pcnoc_bus_timeout5_ahb_clk
    gosub Find_Print_Clock gcc_pcnoc_bus_timeout6_ahb_clk
    gosub Find_Print_Clock gcc_pcnoc_bus_timeout7_ahb_clk
    gosub Find_Print_Clock gcc_pcnoc_bus_timeout8_ahb_clk
    gosub Find_Print_Clock gcc_pcnoc_bus_timeout9_ahb_clk
    gosub Find_Print_Clock gcc_pdm2_clk
    gosub Find_Print_Clock gcc_pdm_ahb_clk
    gosub Find_Print_Clock gcc_pdm_xo4_clk
    gosub Find_Print_Clock gcc_prng_ahb_clk
    gosub Find_Print_Clock gcc_qdss_at_clk
    gosub Find_Print_Clock gcc_qdss_cfg_ahb_clk
    gosub Find_Print_Clock gcc_qdss_dap_ahb_clk
    gosub Find_Print_Clock gcc_qdss_dap_clk
    gosub Find_Print_Clock gcc_qdss_etr_usb_clk
    gosub Find_Print_Clock gcc_qdss_stm_clk
    gosub Find_Print_Clock gcc_qdss_traceclkin_clk
    gosub Find_Print_Clock gcc_qdss_tsctr_div16_clk
    gosub Find_Print_Clock gcc_qdss_tsctr_div2_clk
    gosub Find_Print_Clock gcc_qdss_tsctr_div3_clk
    gosub Find_Print_Clock gcc_qdss_tsctr_div4_clk
    gosub Find_Print_Clock gcc_qdss_tsctr_div8_clk
    gosub Find_Print_Clock gcc_qpic_ahb_clk
    gosub Find_Print_Clock gcc_qpic_clk
    gosub Find_Print_Clock gcc_qpic_system_clk
    gosub Find_Print_Clock gcc_rbcpr_ahb_clk
    gosub Find_Print_Clock gcc_rbcpr_clk
    gosub Find_Print_Clock gcc_rpm_bus_ahb_clk
    gosub Find_Print_Clock gcc_rpm_proc_fclk
    gosub Find_Print_Clock gcc_rpm_proc_hclk
    gosub Find_Print_Clock gcc_rpm_sleep_clk
    gosub Find_Print_Clock gcc_rpm_timer_clk
    gosub Find_Print_Clock gcc_rpm_cfg_xpu_clk
    gosub Find_Print_Clock gcc_sdcc1_ahb_clk
    gosub Find_Print_Clock gcc_sdcc1_apps_clk
    gosub Find_Print_Clock gcc_sdcc2_ahb_clk
    gosub Find_Print_Clock gcc_sdcc2_apps_clk
    gosub Find_Print_Clock gcc_apss_tcu_async_clk
    gosub Find_Print_Clock gcc_apss_tcu_clk
    gosub Find_Print_Clock gcc_gfx_tbu_clk
    gosub Find_Print_Clock gcc_gfx_tcu_clk
    gosub Find_Print_Clock gcc_gtcu_ahb_clk
    gosub Find_Print_Clock gcc_mdp_tbu_clk
    gosub Find_Print_Clock gcc_mss_tbu_q6_axi_clk
    gosub Find_Print_Clock gcc_mss_tbu_axi_clk
    gosub Find_Print_Clock gcc_mss_tbu_gss_axi_clk
    gosub Find_Print_Clock gcc_pcnoc_tbu_clk
    gosub Find_Print_Clock gcc_pronto_tbu_clk
    gosub Find_Print_Clock gcc_smmu_cats_clk
    gosub Find_Print_Clock gcc_smmu_cfg_clk
    gosub Find_Print_Clock gcc_smmu_xpu_clk
    gosub Find_Print_Clock gcc_venus_tbu_clk
    gosub Find_Print_Clock gcc_vfe_tbu_clk
    gosub Find_Print_Clock gcc_snoc_bus_timeout0_ahb_clk
    gosub Find_Print_Clock gcc_spdm_bimc_cy_clk
    gosub Find_Print_Clock gcc_spdm_cfg_ahb_clk
    gosub Find_Print_Clock gcc_spdm_ff_clk
    gosub Find_Print_Clock gcc_spdm_mstr_ahb_clk
    gosub Find_Print_Clock gcc_spdm_pcnoc_cy_clk
    gosub Find_Print_Clock gcc_spdm_rpm_cy_clk
    gosub Find_Print_Clock gcc_spdm_snoc_cy_clk
    gosub Find_Print_Clock gcc_ultaudio_ahbfabric_efabric_spdm_clk
    gosub Find_Print_Clock gcc_spmi_ahb_clk
    gosub Find_Print_Clock gcc_spmi_pcnoc_ahb_clk
    gosub Find_Print_Clock gcc_spmi_ser_clk
    gosub Find_Print_Clock gcc_sec_ctrl_acc_clk
    gosub Find_Print_Clock gcc_sec_ctrl_ahb_clk
    gosub Find_Print_Clock gcc_sec_ctrl_boot_rom_patch_clk
    gosub Find_Print_Clock gcc_sec_ctrl_clk
    gosub Find_Print_Clock gcc_sec_ctrl_sense_clk
    gosub Find_Print_Clock gcc_snoc_pcnoc_ahb_clk
    gosub Find_Print_Clock gcc_sys_noc_apss_ahb_clk
    gosub Find_Print_Clock gcc_sys_noc_at_clk
    gosub Find_Print_Clock gcc_sys_noc_axi_clk
    gosub Find_Print_Clock gcc_sys_noc_qdss_stm_axi_clk
    gosub Find_Print_Clock gcc_tcsr_ahb_clk
    gosub Find_Print_Clock gcc_tlmm_ahb_clk
    gosub Find_Print_Clock gcc_tlmm_clk
    gosub Find_Print_Clock gcc_ultaudio_lpaif_aux_i2s_clk
    gosub Find_Print_Clock gcc_ultaudio_ext_mclk2_clk
    gosub Find_Print_Clock gcc_ultaudio_pcm_data_oe_clk
    gosub Find_Print_Clock gcc_ultaudio_lpaif_pri_i2s_clk
    gosub Find_Print_Clock gcc_ultaudio_lpaif_sec_i2s_clk
    gosub Find_Print_Clock gcc_usb2a_phy_sleep_clk
    gosub Find_Print_Clock gcc_usb_hs_phy_cfg_ahb_clk
    gosub Find_Print_Clock gcc_usb_hs_ahb_clk
    gosub Find_Print_Clock gcc_usb_hs_inactivity_timers_clk
    gosub Find_Print_Clock gcc_usb_hs_system_clk
    gosub Find_Print_Clock gcc_venus0_ahb_clk
    gosub Find_Print_Clock gcc_venus0_axi_clk
    gosub Find_Print_Clock gcc_venus0_core0_vcodec0_clk
    gosub Find_Print_Clock gcc_venus0_qdss_apb_clk
    gosub Find_Print_Clock gcc_venus0_qdss_at_clk
    gosub Find_Print_Clock gcc_venus0_qdss_tsctr_div8_clk
    gosub Find_Print_Clock gcc_venus0_vcodec0_clk
    gosub Find_Print_Clock gcc_pcnoc_mpu_cfg_ahb_clk
    gosub Find_Print_Clock gcc_prng_xpu_cfg_ahb_clk

    &choice_handled=1
    return
  )
  else if ("&choice"=="wcss_all")
  (
    gosub Find_Print_Clock wcss_bt_32m_clk_src
    gosub Find_Print_Clock wcss_bt_fm_19m_clk_src
    gosub Find_Print_Clock wcss_common_ahb_clk
    gosub Find_Print_Clock wcss_common_bt_32m_clk
    gosub Find_Print_Clock wcss_common_bt_fm_19m_clk
    gosub Find_Print_Clock wcss_common_cpu_clk
    gosub Find_Print_Clock wcss_common_phy_dbg_clk
    gosub Find_Print_Clock wcss_common_slp_clk
    gosub Find_Print_Clock wcss_common_trc_clk
    gosub Find_Print_Clock wcss_common_xo_clk
    gosub Find_Print_Clock o_wcss_ahb_s0_clk
    gosub Find_Print_Clock o_wcss_axi_m_clk
    gosub Find_Print_Clock o_wcss_bus_timeout_clk
    gosub Find_Print_Clock wcss_cpu_ahb_clk_src
    gosub Find_Print_Clock wcss_slp_clk_src
    gosub Find_Print_Clock wcss_top_ahb_clk
    gosub Find_Print_Clock wcss_top_slp_clk
    gosub Find_Print_Clock wcss_top_xo_clk
    gosub Find_Print_Clock wcss_xo_clk_src
    gosub Find_Print_Clock o_wcss_adc_240m_clk
    gosub Find_Print_Clock wcss_dac_sm_clk
    gosub Find_Print_Clock wcss_rfif_clk_src
    gosub Find_Print_Clock wcss_wlan_adc_clk
    gosub Find_Print_Clock wcss_wlan_ahb_clk
    gosub Find_Print_Clock wcss_wlan_phy_dac_clk
    gosub Find_Print_Clock wcss_wlan_phy_dbg_clk
    gosub Find_Print_Clock wcss_wlan_phy_main1_fast_clk
    gosub Find_Print_Clock wcss_wlan_rfa_cal_clk
    gosub Find_Print_Clock wcss_wlan_rfif_clk
    gosub Find_Print_Clock wlan_phy_main1_rx_clk
    gosub Find_Print_Clock wlan_phy_main1_tx_clk
    gosub Find_Print_Clock wlan_phy_main2_clk

    &choice_handled=1
    return
  )
  else if ("&choice"=="apcs_all")
  (
    gosub Find_Print_Clock apcs_hdcd_ahbgated_clk
    gosub Find_Print_Clock apcs_imref_clk
    gosub Find_Print_Clock apcs_imsleep_clk
    gosub Find_Print_Clock apcs_l2leaf_clk
    gosub Find_Print_Clock apcs_leaf0_clk
    gosub Find_Print_Clock apcs_leaf1_clk
    gosub Find_Print_Clock apcs_leaf2_clk
    gosub Find_Print_Clock apcs_leaf3_clk
    gosub Find_Print_Clock apcs_sysqsb_clk

    &choice_handled=1
    return
  )

  return
  

  
Find_Print_Clock:

ENTRY &clk

&clk_test=0
&clk_reg=0
&clk_reg_name=""


; Setting appropriate access mode for non-MSS clocks
&clk_access_mod="a:"

  &match=0
  &wild_head=0
  &wild_tail=0
  &clk_input_length=STRING.LENGTH("&clk")
  &clk_itr_length=STRING.LENGTH("apss_gcc_dbg_clk")

  if (STRING.SCAN("&clk", "*", 0)==0)
  (
    &wild_head=1
  )
  if (STRING.SCAN("&clk", "*", 1)==(STRING.LENGTH("&clk")-1))
  (
    &wild_tail=1
  )

  if ((&wild_head==1)&&(&wild_tail==1))
  (
    if (STRING.SCAN("apss_gcc_dbg_clk", STRING.MID("&clk", 1, &clk_input_length-2), 0)!=-1)
    ( 
      &match=1
    )
  )
  else if (&wild_head==1)
  (
    if (STRING.MID("apss_gcc_dbg_clk", &clk_itr_length-&clk_input_length+1, &clk_input_length-1)==STRING.CUT("&clk", 1))
    ( 
      &match=1
    )
  )
  else if (&wild_tail==1)
  (
    if (STRING.MID("apss_gcc_dbg_clk", 0, &clk_input_length-1)==STRING.CUT("&clk", -1))
    ( 
      &match=1
    )
  )	  
  else if ("apss_gcc_dbg_clk"=="&clk")
  (
    &match=1
  )
  
  if (&match==1)
  (
    &clk_test=&CLK_TEST_APSS_GCC_DBG_CLK
    &clk_reg=0
    &clk_reg_name="No CBCR"
    &clk_name="apss_gcc_dbg_clk"
    &clk_reg_cbcr_type="ext"

    gosub Print_Clk_Info_Line
  )
  
  &match=0
  &wild_head=0
  &wild_tail=0
  &clk_input_length=STRING.LENGTH("&clk")
  &clk_itr_length=STRING.LENGTH("gcc_apss_ahb_clk")

  if (STRING.SCAN("&clk", "*", 0)==0)
  (
    &wild_head=1
  )
  if (STRING.SCAN("&clk", "*", 1)==(STRING.LENGTH("&clk")-1))
  (
    &wild_tail=1
  )

  if ((&wild_head==1)&&(&wild_tail==1))
  (
    if (STRING.SCAN("gcc_apss_ahb_clk", STRING.MID("&clk", 1, &clk_input_length-2), 0)!=-1)
    ( 
      &match=1
    )
  )
  else if (&wild_head==1)
  (
    if (STRING.MID("gcc_apss_ahb_clk", &clk_itr_length-&clk_input_length+1, &clk_input_length-1)==STRING.CUT("&clk", 1))
    ( 
      &match=1
    )
  )
  else if (&wild_tail==1)
  (
    if (STRING.MID("gcc_apss_ahb_clk", 0, &clk_input_length-1)==STRING.CUT("&clk", -1))
    ( 
      &match=1
    )
  )	  
  else if ("gcc_apss_ahb_clk"=="&clk")
  (
    &match=1
  )
  
  if (&match==1)
  (
    &clk_test=&CLK_TEST_GCC_APSS_AHB_CLK
    &clk_reg=&HWIO_GCC_APSS_AHB_CBCR_ADDR
    &clk_reg_name="GCC_APSS_AHB_CBCR"
    &clk_name="gcc_apss_ahb_clk"
    &clk_reg_cbcr_type="sm_cbc"

    gosub Print_Clk_Info_Line
  )
  
  &match=0
  &wild_head=0
  &wild_tail=0
  &clk_input_length=STRING.LENGTH("&clk")
  &clk_itr_length=STRING.LENGTH("gcc_apss_axi_clk")

  if (STRING.SCAN("&clk", "*", 0)==0)
  (
    &wild_head=1
  )
  if (STRING.SCAN("&clk", "*", 1)==(STRING.LENGTH("&clk")-1))
  (
    &wild_tail=1
  )

  if ((&wild_head==1)&&(&wild_tail==1))
  (
    if (STRING.SCAN("gcc_apss_axi_clk", STRING.MID("&clk", 1, &clk_input_length-2), 0)!=-1)
    ( 
      &match=1
    )
  )
  else if (&wild_head==1)
  (
    if (STRING.MID("gcc_apss_axi_clk", &clk_itr_length-&clk_input_length+1, &clk_input_length-1)==STRING.CUT("&clk", 1))
    ( 
      &match=1
    )
  )
  else if (&wild_tail==1)
  (
    if (STRING.MID("gcc_apss_axi_clk", 0, &clk_input_length-1)==STRING.CUT("&clk", -1))
    ( 
      &match=1
    )
  )	  
  else if ("gcc_apss_axi_clk"=="&clk")
  (
    &match=1
  )
  
  if (&match==1)
  (
    &clk_test=&CLK_TEST_GCC_APSS_AXI_CLK
    &clk_reg=&HWIO_GCC_APSS_AXI_CBCR_ADDR
    &clk_reg_name="GCC_APSS_AXI_CBCR"
    &clk_name="gcc_apss_axi_clk"
    &clk_reg_cbcr_type="sm_cbc"

    gosub Print_Clk_Info_Line
  )
  
  &match=0
  &wild_head=0
  &wild_tail=0
  &clk_input_length=STRING.LENGTH("&clk")
  &clk_itr_length=STRING.LENGTH("gcc_ultaudio_ahbfabric_ixfabric_clk")

  if (STRING.SCAN("&clk", "*", 0)==0)
  (
    &wild_head=1
  )
  if (STRING.SCAN("&clk", "*", 1)==(STRING.LENGTH("&clk")-1))
  (
    &wild_tail=1
  )

  if ((&wild_head==1)&&(&wild_tail==1))
  (
    if (STRING.SCAN("gcc_ultaudio_ahbfabric_ixfabric_clk", STRING.MID("&clk", 1, &clk_input_length-2), 0)!=-1)
    ( 
      &match=1
    )
  )
  else if (&wild_head==1)
  (
    if (STRING.MID("gcc_ultaudio_ahbfabric_ixfabric_clk", &clk_itr_length-&clk_input_length+1, &clk_input_length-1)==STRING.CUT("&clk", 1))
    ( 
      &match=1
    )
  )
  else if (&wild_tail==1)
  (
    if (STRING.MID("gcc_ultaudio_ahbfabric_ixfabric_clk", 0, &clk_input_length-1)==STRING.CUT("&clk", -1))
    ( 
      &match=1
    )
  )	  
  else if ("gcc_ultaudio_ahbfabric_ixfabric_clk"=="&clk")
  (
    &match=1
  )
  
  if (&match==1)
  (
    &clk_test=&CLK_TEST_GCC_ULTAUDIO_AHBFABRIC_IXFABRIC_CLK
    &clk_reg=&HWIO_GCC_ULTAUDIO_AHBFABRIC_IXFABRIC_CBCR_ADDR
    &clk_reg_name="GCC_ULTAUDIO_AHBFABRIC_IXFABRIC_CBCR"
    &clk_name="gcc_ultaudio_ahbfabric_ixfabric_clk"
    &clk_reg_cbcr_type="sm_cbc"

    gosub Print_Clk_Info_Line
  )
  
  &match=0
  &wild_head=0
  &wild_tail=0
  &clk_input_length=STRING.LENGTH("&clk")
  &clk_itr_length=STRING.LENGTH("gcc_ultaudio_ahbfabric_ixfabric_lpm_clk")

  if (STRING.SCAN("&clk", "*", 0)==0)
  (
    &wild_head=1
  )
  if (STRING.SCAN("&clk", "*", 1)==(STRING.LENGTH("&clk")-1))
  (
    &wild_tail=1
  )

  if ((&wild_head==1)&&(&wild_tail==1))
  (
    if (STRING.SCAN("gcc_ultaudio_ahbfabric_ixfabric_lpm_clk", STRING.MID("&clk", 1, &clk_input_length-2), 0)!=-1)
    ( 
      &match=1
    )
  )
  else if (&wild_head==1)
  (
    if (STRING.MID("gcc_ultaudio_ahbfabric_ixfabric_lpm_clk", &clk_itr_length-&clk_input_length+1, &clk_input_length-1)==STRING.CUT("&clk", 1))
    ( 
      &match=1
    )
  )
  else if (&wild_tail==1)
  (
    if (STRING.MID("gcc_ultaudio_ahbfabric_ixfabric_lpm_clk", 0, &clk_input_length-1)==STRING.CUT("&clk", -1))
    ( 
      &match=1
    )
  )	  
  else if ("gcc_ultaudio_ahbfabric_ixfabric_lpm_clk"=="&clk")
  (
    &match=1
  )
  
  if (&match==1)
  (
    &clk_test=&CLK_TEST_GCC_ULTAUDIO_AHBFABRIC_IXFABRIC_LPM_CLK
    &clk_reg=&HWIO_GCC_ULTAUDIO_AHBFABRIC_IXFABRIC_LPM_CBCR_ADDR
    &clk_reg_name="GCC_ULTAUDIO_AHBFABRIC_IXFABRIC_LPM_CBCR"
    &clk_name="gcc_ultaudio_ahbfabric_ixfabric_lpm_clk"
    &clk_reg_cbcr_type="sm_pscbc"

    gosub Print_Clk_Info_Line
  )
  
  &match=0
  &wild_head=0
  &wild_tail=0
  &clk_input_length=STRING.LENGTH("&clk")
  &clk_itr_length=STRING.LENGTH("gcc_ultaudio_pcnoc_mport_clk")

  if (STRING.SCAN("&clk", "*", 0)==0)
  (
    &wild_head=1
  )
  if (STRING.SCAN("&clk", "*", 1)==(STRING.LENGTH("&clk")-1))
  (
    &wild_tail=1
  )

  if ((&wild_head==1)&&(&wild_tail==1))
  (
    if (STRING.SCAN("gcc_ultaudio_pcnoc_mport_clk", STRING.MID("&clk", 1, &clk_input_length-2), 0)!=-1)
    ( 
      &match=1
    )
  )
  else if (&wild_head==1)
  (
    if (STRING.MID("gcc_ultaudio_pcnoc_mport_clk", &clk_itr_length-&clk_input_length+1, &clk_input_length-1)==STRING.CUT("&clk", 1))
    ( 
      &match=1
    )
  )
  else if (&wild_tail==1)
  (
    if (STRING.MID("gcc_ultaudio_pcnoc_mport_clk", 0, &clk_input_length-1)==STRING.CUT("&clk", -1))
    ( 
      &match=1
    )
  )	  
  else if ("gcc_ultaudio_pcnoc_mport_clk"=="&clk")
  (
    &match=1
  )
  
  if (&match==1)
  (
    &clk_test=&CLK_TEST_GCC_ULTAUDIO_PCNOC_MPORT_CLK
    &clk_reg=&HWIO_GCC_ULTAUDIO_PCNOC_MPORT_CBCR_ADDR
    &clk_reg_name="GCC_ULTAUDIO_PCNOC_MPORT_CBCR"
    &clk_name="gcc_ultaudio_pcnoc_mport_clk"
    &clk_reg_cbcr_type="sm_cbc"

    gosub Print_Clk_Info_Line
  )
  
  &match=0
  &wild_head=0
  &wild_tail=0
  &clk_input_length=STRING.LENGTH("&clk")
  &clk_itr_length=STRING.LENGTH("gcc_ultaudio_pcnoc_sway_clk")

  if (STRING.SCAN("&clk", "*", 0)==0)
  (
    &wild_head=1
  )
  if (STRING.SCAN("&clk", "*", 1)==(STRING.LENGTH("&clk")-1))
  (
    &wild_tail=1
  )

  if ((&wild_head==1)&&(&wild_tail==1))
  (
    if (STRING.SCAN("gcc_ultaudio_pcnoc_sway_clk", STRING.MID("&clk", 1, &clk_input_length-2), 0)!=-1)
    ( 
      &match=1
    )
  )
  else if (&wild_head==1)
  (
    if (STRING.MID("gcc_ultaudio_pcnoc_sway_clk", &clk_itr_length-&clk_input_length+1, &clk_input_length-1)==STRING.CUT("&clk", 1))
    ( 
      &match=1
    )
  )
  else if (&wild_tail==1)
  (
    if (STRING.MID("gcc_ultaudio_pcnoc_sway_clk", 0, &clk_input_length-1)==STRING.CUT("&clk", -1))
    ( 
      &match=1
    )
  )	  
  else if ("gcc_ultaudio_pcnoc_sway_clk"=="&clk")
  (
    &match=1
  )
  
  if (&match==1)
  (
    &clk_test=&CLK_TEST_GCC_ULTAUDIO_PCNOC_SWAY_CLK
    &clk_reg=&HWIO_GCC_ULTAUDIO_PCNOC_SWAY_CBCR_ADDR
    &clk_reg_name="GCC_ULTAUDIO_PCNOC_SWAY_CBCR"
    &clk_name="gcc_ultaudio_pcnoc_sway_clk"
    &clk_reg_cbcr_type="sm_cbc"

    gosub Print_Clk_Info_Line
  )
  
  &match=0
  &wild_head=0
  &wild_tail=0
  &clk_input_length=STRING.LENGTH("&clk")
  &clk_itr_length=STRING.LENGTH("gcc_ultaudio_avsync_xo_clk")

  if (STRING.SCAN("&clk", "*", 0)==0)
  (
    &wild_head=1
  )
  if (STRING.SCAN("&clk", "*", 1)==(STRING.LENGTH("&clk")-1))
  (
    &wild_tail=1
  )

  if ((&wild_head==1)&&(&wild_tail==1))
  (
    if (STRING.SCAN("gcc_ultaudio_avsync_xo_clk", STRING.MID("&clk", 1, &clk_input_length-2), 0)!=-1)
    ( 
      &match=1
    )
  )
  else if (&wild_head==1)
  (
    if (STRING.MID("gcc_ultaudio_avsync_xo_clk", &clk_itr_length-&clk_input_length+1, &clk_input_length-1)==STRING.CUT("&clk", 1))
    ( 
      &match=1
    )
  )
  else if (&wild_tail==1)
  (
    if (STRING.MID("gcc_ultaudio_avsync_xo_clk", 0, &clk_input_length-1)==STRING.CUT("&clk", -1))
    ( 
      &match=1
    )
  )	  
  else if ("gcc_ultaudio_avsync_xo_clk"=="&clk")
  (
    &match=1
  )
  
  if (&match==1)
  (
    &clk_test=&CLK_TEST_GCC_ULTAUDIO_AVSYNC_XO_CLK
    &clk_reg=&HWIO_GCC_ULTAUDIO_AVSYNC_XO_CBCR_ADDR
    &clk_reg_name="GCC_ULTAUDIO_AVSYNC_XO_CBCR"
    &clk_name="gcc_ultaudio_avsync_xo_clk"
    &clk_reg_cbcr_type="sm_cbc"

    gosub Print_Clk_Info_Line
  )
  
  &match=0
  &wild_head=0
  &wild_tail=0
  &clk_input_length=STRING.LENGTH("&clk")
  &clk_itr_length=STRING.LENGTH("gcc_ultaudio_stc_xo_clk")

  if (STRING.SCAN("&clk", "*", 0)==0)
  (
    &wild_head=1
  )
  if (STRING.SCAN("&clk", "*", 1)==(STRING.LENGTH("&clk")-1))
  (
    &wild_tail=1
  )

  if ((&wild_head==1)&&(&wild_tail==1))
  (
    if (STRING.SCAN("gcc_ultaudio_stc_xo_clk", STRING.MID("&clk", 1, &clk_input_length-2), 0)!=-1)
    ( 
      &match=1
    )
  )
  else if (&wild_head==1)
  (
    if (STRING.MID("gcc_ultaudio_stc_xo_clk", &clk_itr_length-&clk_input_length+1, &clk_input_length-1)==STRING.CUT("&clk", 1))
    ( 
      &match=1
    )
  )
  else if (&wild_tail==1)
  (
    if (STRING.MID("gcc_ultaudio_stc_xo_clk", 0, &clk_input_length-1)==STRING.CUT("&clk", -1))
    ( 
      &match=1
    )
  )	  
  else if ("gcc_ultaudio_stc_xo_clk"=="&clk")
  (
    &match=1
  )
  
  if (&match==1)
  (
    &clk_test=&CLK_TEST_GCC_ULTAUDIO_STC_XO_CLK
    &clk_reg=&HWIO_GCC_ULTAUDIO_STC_XO_CBCR_ADDR
    &clk_reg_name="GCC_ULTAUDIO_STC_XO_CBCR"
    &clk_name="gcc_ultaudio_stc_xo_clk"
    &clk_reg_cbcr_type="sm_cbc"

    gosub Print_Clk_Info_Line
  )
  
  &match=0
  &wild_head=0
  &wild_tail=0
  &clk_input_length=STRING.LENGTH("&clk")
  &clk_itr_length=STRING.LENGTH("gcc_codec_digcodec_clk")

  if (STRING.SCAN("&clk", "*", 0)==0)
  (
    &wild_head=1
  )
  if (STRING.SCAN("&clk", "*", 1)==(STRING.LENGTH("&clk")-1))
  (
    &wild_tail=1
  )

  if ((&wild_head==1)&&(&wild_tail==1))
  (
    if (STRING.SCAN("gcc_codec_digcodec_clk", STRING.MID("&clk", 1, &clk_input_length-2), 0)!=-1)
    ( 
      &match=1
    )
  )
  else if (&wild_head==1)
  (
    if (STRING.MID("gcc_codec_digcodec_clk", &clk_itr_length-&clk_input_length+1, &clk_input_length-1)==STRING.CUT("&clk", 1))
    ( 
      &match=1
    )
  )
  else if (&wild_tail==1)
  (
    if (STRING.MID("gcc_codec_digcodec_clk", 0, &clk_input_length-1)==STRING.CUT("&clk", -1))
    ( 
      &match=1
    )
  )	  
  else if ("gcc_codec_digcodec_clk"=="&clk")
  (
    &match=1
  )
  
  if (&match==1)
  (
    &clk_test=&CLK_TEST_GCC_CODEC_DIGCODEC_CLK
    &clk_reg=&HWIO_GCC_CODEC_DIGCODEC_CBCR_ADDR
    &clk_reg_name="GCC_CODEC_DIGCODEC_CBCR"
    &clk_name="gcc_codec_digcodec_clk"
    &clk_reg_cbcr_type="sm_cbc"

    gosub Print_Clk_Info_Line
  )
  
  &match=0
  &wild_head=0
  &wild_tail=0
  &clk_input_length=STRING.LENGTH("&clk")
  &clk_itr_length=STRING.LENGTH("gcc_bimc_apss_axi_clk")

  if (STRING.SCAN("&clk", "*", 0)==0)
  (
    &wild_head=1
  )
  if (STRING.SCAN("&clk", "*", 1)==(STRING.LENGTH("&clk")-1))
  (
    &wild_tail=1
  )

  if ((&wild_head==1)&&(&wild_tail==1))
  (
    if (STRING.SCAN("gcc_bimc_apss_axi_clk", STRING.MID("&clk", 1, &clk_input_length-2), 0)!=-1)
    ( 
      &match=1
    )
  )
  else if (&wild_head==1)
  (
    if (STRING.MID("gcc_bimc_apss_axi_clk", &clk_itr_length-&clk_input_length+1, &clk_input_length-1)==STRING.CUT("&clk", 1))
    ( 
      &match=1
    )
  )
  else if (&wild_tail==1)
  (
    if (STRING.MID("gcc_bimc_apss_axi_clk", 0, &clk_input_length-1)==STRING.CUT("&clk", -1))
    ( 
      &match=1
    )
  )	  
  else if ("gcc_bimc_apss_axi_clk"=="&clk")
  (
    &match=1
  )
  
  if (&match==1)
  (
    &clk_test=&CLK_TEST_GCC_BIMC_APSS_AXI_CLK
    &clk_reg=&HWIO_GCC_BIMC_APSS_AXI_CBCR_ADDR
    &clk_reg_name="GCC_BIMC_APSS_AXI_CBCR"
    &clk_name="gcc_bimc_apss_axi_clk"
    &clk_reg_cbcr_type="sm_cbc"

    gosub Print_Clk_Info_Line
  )
  
  &match=0
  &wild_head=0
  &wild_tail=0
  &clk_input_length=STRING.LENGTH("&clk")
  &clk_itr_length=STRING.LENGTH("gcc_bimc_at_clk")

  if (STRING.SCAN("&clk", "*", 0)==0)
  (
    &wild_head=1
  )
  if (STRING.SCAN("&clk", "*", 1)==(STRING.LENGTH("&clk")-1))
  (
    &wild_tail=1
  )

  if ((&wild_head==1)&&(&wild_tail==1))
  (
    if (STRING.SCAN("gcc_bimc_at_clk", STRING.MID("&clk", 1, &clk_input_length-2), 0)!=-1)
    ( 
      &match=1
    )
  )
  else if (&wild_head==1)
  (
    if (STRING.MID("gcc_bimc_at_clk", &clk_itr_length-&clk_input_length+1, &clk_input_length-1)==STRING.CUT("&clk", 1))
    ( 
      &match=1
    )
  )
  else if (&wild_tail==1)
  (
    if (STRING.MID("gcc_bimc_at_clk", 0, &clk_input_length-1)==STRING.CUT("&clk", -1))
    ( 
      &match=1
    )
  )	  
  else if ("gcc_bimc_at_clk"=="&clk")
  (
    &match=1
  )
  
  if (&match==1)
  (
    &clk_test=&CLK_TEST_GCC_BIMC_AT_CLK
    &clk_reg=0
    &clk_reg_name="No CBCR"
    &clk_name="gcc_bimc_at_clk"
    &clk_reg_cbcr_type="ACGC"

    gosub Print_Clk_Info_Line
  )
  
  &match=0
  &wild_head=0
  &wild_tail=0
  &clk_input_length=STRING.LENGTH("&clk")
  &clk_itr_length=STRING.LENGTH("gcc_bimc_cfg_ahb_clk")

  if (STRING.SCAN("&clk", "*", 0)==0)
  (
    &wild_head=1
  )
  if (STRING.SCAN("&clk", "*", 1)==(STRING.LENGTH("&clk")-1))
  (
    &wild_tail=1
  )

  if ((&wild_head==1)&&(&wild_tail==1))
  (
    if (STRING.SCAN("gcc_bimc_cfg_ahb_clk", STRING.MID("&clk", 1, &clk_input_length-2), 0)!=-1)
    ( 
      &match=1
    )
  )
  else if (&wild_head==1)
  (
    if (STRING.MID("gcc_bimc_cfg_ahb_clk", &clk_itr_length-&clk_input_length+1, &clk_input_length-1)==STRING.CUT("&clk", 1))
    ( 
      &match=1
    )
  )
  else if (&wild_tail==1)
  (
    if (STRING.MID("gcc_bimc_cfg_ahb_clk", 0, &clk_input_length-1)==STRING.CUT("&clk", -1))
    ( 
      &match=1
    )
  )	  
  else if ("gcc_bimc_cfg_ahb_clk"=="&clk")
  (
    &match=1
  )
  
  if (&match==1)
  (
    &clk_test=&CLK_TEST_GCC_BIMC_CFG_AHB_CLK
    &clk_reg=&HWIO_GCC_BIMC_CFG_AHB_CBCR_ADDR
    &clk_reg_name="GCC_BIMC_CFG_AHB_CBCR"
    &clk_name="gcc_bimc_cfg_ahb_clk"
    &clk_reg_cbcr_type="sm_cbc"

    gosub Print_Clk_Info_Line
  )
  
  &match=0
  &wild_head=0
  &wild_tail=0
  &clk_input_length=STRING.LENGTH("&clk")
  &clk_itr_length=STRING.LENGTH("gcc_bimc_clk")

  if (STRING.SCAN("&clk", "*", 0)==0)
  (
    &wild_head=1
  )
  if (STRING.SCAN("&clk", "*", 1)==(STRING.LENGTH("&clk")-1))
  (
    &wild_tail=1
  )

  if ((&wild_head==1)&&(&wild_tail==1))
  (
    if (STRING.SCAN("gcc_bimc_clk", STRING.MID("&clk", 1, &clk_input_length-2), 0)!=-1)
    ( 
      &match=1
    )
  )
  else if (&wild_head==1)
  (
    if (STRING.MID("gcc_bimc_clk", &clk_itr_length-&clk_input_length+1, &clk_input_length-1)==STRING.CUT("&clk", 1))
    ( 
      &match=1
    )
  )
  else if (&wild_tail==1)
  (
    if (STRING.MID("gcc_bimc_clk", 0, &clk_input_length-1)==STRING.CUT("&clk", -1))
    ( 
      &match=1
    )
  )	  
  else if ("gcc_bimc_clk"=="&clk")
  (
    &match=1
  )
  
  ; This clock belongs to the 'buses' display group.
  if ("buses"=="&clk")
  (
    &match=1	  
  )
  
  if (&match==1)
  (
    &clk_test=&CLK_TEST_GCC_BIMC_CLK
    &clk_reg=&HWIO_GCC_BIMC_CBCR_ADDR
    &clk_reg_name="GCC_BIMC_CBCR"
    &clk_name="gcc_bimc_clk"
    &clk_reg_cbcr_type="sm_cbc"

    gosub Print_Clk_Info_Line
  )
  
  &match=0
  &wild_head=0
  &wild_tail=0
  &clk_input_length=STRING.LENGTH("&clk")
  &clk_itr_length=STRING.LENGTH("gcc_bimc_gpu_clk")

  if (STRING.SCAN("&clk", "*", 0)==0)
  (
    &wild_head=1
  )
  if (STRING.SCAN("&clk", "*", 1)==(STRING.LENGTH("&clk")-1))
  (
    &wild_tail=1
  )

  if ((&wild_head==1)&&(&wild_tail==1))
  (
    if (STRING.SCAN("gcc_bimc_gpu_clk", STRING.MID("&clk", 1, &clk_input_length-2), 0)!=-1)
    ( 
      &match=1
    )
  )
  else if (&wild_head==1)
  (
    if (STRING.MID("gcc_bimc_gpu_clk", &clk_itr_length-&clk_input_length+1, &clk_input_length-1)==STRING.CUT("&clk", 1))
    ( 
      &match=1
    )
  )
  else if (&wild_tail==1)
  (
    if (STRING.MID("gcc_bimc_gpu_clk", 0, &clk_input_length-1)==STRING.CUT("&clk", -1))
    ( 
      &match=1
    )
  )	  
  else if ("gcc_bimc_gpu_clk"=="&clk")
  (
    &match=1
  )
  
  if (&match==1)
  (
    &clk_test=&CLK_TEST_GCC_BIMC_GPU_CLK
    &clk_reg=&HWIO_GCC_BIMC_GPU_CBCR_ADDR
    &clk_reg_name="GCC_BIMC_GPU_CBCR"
    &clk_name="gcc_bimc_gpu_clk"
    &clk_reg_cbcr_type="sm_cbc"

    gosub Print_Clk_Info_Line
  )
  
  &match=0
  &wild_head=0
  &wild_tail=0
  &clk_input_length=STRING.LENGTH("&clk")
  &clk_itr_length=STRING.LENGTH("gcc_bimc_sleep_clk")

  if (STRING.SCAN("&clk", "*", 0)==0)
  (
    &wild_head=1
  )
  if (STRING.SCAN("&clk", "*", 1)==(STRING.LENGTH("&clk")-1))
  (
    &wild_tail=1
  )

  if ((&wild_head==1)&&(&wild_tail==1))
  (
    if (STRING.SCAN("gcc_bimc_sleep_clk", STRING.MID("&clk", 1, &clk_input_length-2), 0)!=-1)
    ( 
      &match=1
    )
  )
  else if (&wild_head==1)
  (
    if (STRING.MID("gcc_bimc_sleep_clk", &clk_itr_length-&clk_input_length+1, &clk_input_length-1)==STRING.CUT("&clk", 1))
    ( 
      &match=1
    )
  )
  else if (&wild_tail==1)
  (
    if (STRING.MID("gcc_bimc_sleep_clk", 0, &clk_input_length-1)==STRING.CUT("&clk", -1))
    ( 
      &match=1
    )
  )	  
  else if ("gcc_bimc_sleep_clk"=="&clk")
  (
    &match=1
  )
  
  if (&match==1)
  (
    &clk_test=&CLK_TEST_GCC_BIMC_SLEEP_CLK
    &clk_reg=&HWIO_GCC_BIMC_SLEEP_CBCR_ADDR
    &clk_reg_name="GCC_BIMC_SLEEP_CBCR"
    &clk_name="gcc_bimc_sleep_clk"
    &clk_reg_cbcr_type="sm_cbc"

    gosub Print_Clk_Info_Line
  )
  
  &match=0
  &wild_head=0
  &wild_tail=0
  &clk_input_length=STRING.LENGTH("&clk")
  &clk_itr_length=STRING.LENGTH("gcc_bimc_sysnoc_axi_clk")

  if (STRING.SCAN("&clk", "*", 0)==0)
  (
    &wild_head=1
  )
  if (STRING.SCAN("&clk", "*", 1)==(STRING.LENGTH("&clk")-1))
  (
    &wild_tail=1
  )

  if ((&wild_head==1)&&(&wild_tail==1))
  (
    if (STRING.SCAN("gcc_bimc_sysnoc_axi_clk", STRING.MID("&clk", 1, &clk_input_length-2), 0)!=-1)
    ( 
      &match=1
    )
  )
  else if (&wild_head==1)
  (
    if (STRING.MID("gcc_bimc_sysnoc_axi_clk", &clk_itr_length-&clk_input_length+1, &clk_input_length-1)==STRING.CUT("&clk", 1))
    ( 
      &match=1
    )
  )
  else if (&wild_tail==1)
  (
    if (STRING.MID("gcc_bimc_sysnoc_axi_clk", 0, &clk_input_length-1)==STRING.CUT("&clk", -1))
    ( 
      &match=1
    )
  )	  
  else if ("gcc_bimc_sysnoc_axi_clk"=="&clk")
  (
    &match=1
  )
  
  if (&match==1)
  (
    &clk_test=&CLK_TEST_GCC_BIMC_SYSNOC_AXI_CLK
    &clk_reg=&HWIO_GCC_BIMC_SYSNOC_AXI_CBCR_ADDR
    &clk_reg_name="GCC_BIMC_SYSNOC_AXI_CBCR"
    &clk_name="gcc_bimc_sysnoc_axi_clk"
    &clk_reg_cbcr_type="sm_cbc"

    gosub Print_Clk_Info_Line
  )
  
  &match=0
  &wild_head=0
  &wild_tail=0
  &clk_input_length=STRING.LENGTH("&clk")
  &clk_itr_length=STRING.LENGTH("gcc_bimc_tcu_clk")

  if (STRING.SCAN("&clk", "*", 0)==0)
  (
    &wild_head=1
  )
  if (STRING.SCAN("&clk", "*", 1)==(STRING.LENGTH("&clk")-1))
  (
    &wild_tail=1
  )

  if ((&wild_head==1)&&(&wild_tail==1))
  (
    if (STRING.SCAN("gcc_bimc_tcu_clk", STRING.MID("&clk", 1, &clk_input_length-2), 0)!=-1)
    ( 
      &match=1
    )
  )
  else if (&wild_head==1)
  (
    if (STRING.MID("gcc_bimc_tcu_clk", &clk_itr_length-&clk_input_length+1, &clk_input_length-1)==STRING.CUT("&clk", 1))
    ( 
      &match=1
    )
  )
  else if (&wild_tail==1)
  (
    if (STRING.MID("gcc_bimc_tcu_clk", 0, &clk_input_length-1)==STRING.CUT("&clk", -1))
    ( 
      &match=1
    )
  )	  
  else if ("gcc_bimc_tcu_clk"=="&clk")
  (
    &match=1
  )
  
  if (&match==1)
  (
    &clk_test=&CLK_TEST_GCC_BIMC_TCU_CLK
    &clk_reg=&HWIO_GCC_BIMC_TCU_CBCR_ADDR
    &clk_reg_name="GCC_BIMC_TCU_CBCR"
    &clk_name="gcc_bimc_tcu_clk"
    &clk_reg_cbcr_type="sm_cbc"

    gosub Print_Clk_Info_Line
  )
  
  &match=0
  &wild_head=0
  &wild_tail=0
  &clk_input_length=STRING.LENGTH("&clk")
  &clk_itr_length=STRING.LENGTH("gcc_bimc_xo_clk")

  if (STRING.SCAN("&clk", "*", 0)==0)
  (
    &wild_head=1
  )
  if (STRING.SCAN("&clk", "*", 1)==(STRING.LENGTH("&clk")-1))
  (
    &wild_tail=1
  )

  if ((&wild_head==1)&&(&wild_tail==1))
  (
    if (STRING.SCAN("gcc_bimc_xo_clk", STRING.MID("&clk", 1, &clk_input_length-2), 0)!=-1)
    ( 
      &match=1
    )
  )
  else if (&wild_head==1)
  (
    if (STRING.MID("gcc_bimc_xo_clk", &clk_itr_length-&clk_input_length+1, &clk_input_length-1)==STRING.CUT("&clk", 1))
    ( 
      &match=1
    )
  )
  else if (&wild_tail==1)
  (
    if (STRING.MID("gcc_bimc_xo_clk", 0, &clk_input_length-1)==STRING.CUT("&clk", -1))
    ( 
      &match=1
    )
  )	  
  else if ("gcc_bimc_xo_clk"=="&clk")
  (
    &match=1
  )
  
  if (&match==1)
  (
    &clk_test=&CLK_TEST_GCC_BIMC_XO_CLK
    &clk_reg=&HWIO_GCC_BIMC_XO_CBCR_ADDR
    &clk_reg_name="GCC_BIMC_XO_CBCR"
    &clk_name="gcc_bimc_xo_clk"
    &clk_reg_cbcr_type="sm_cbc"

    gosub Print_Clk_Info_Line
  )
  
  &match=0
  &wild_head=0
  &wild_tail=0
  &clk_input_length=STRING.LENGTH("&clk")
  &clk_itr_length=STRING.LENGTH("gcc_blsp1_ahb_clk")

  if (STRING.SCAN("&clk", "*", 0)==0)
  (
    &wild_head=1
  )
  if (STRING.SCAN("&clk", "*", 1)==(STRING.LENGTH("&clk")-1))
  (
    &wild_tail=1
  )

  if ((&wild_head==1)&&(&wild_tail==1))
  (
    if (STRING.SCAN("gcc_blsp1_ahb_clk", STRING.MID("&clk", 1, &clk_input_length-2), 0)!=-1)
    ( 
      &match=1
    )
  )
  else if (&wild_head==1)
  (
    if (STRING.MID("gcc_blsp1_ahb_clk", &clk_itr_length-&clk_input_length+1, &clk_input_length-1)==STRING.CUT("&clk", 1))
    ( 
      &match=1
    )
  )
  else if (&wild_tail==1)
  (
    if (STRING.MID("gcc_blsp1_ahb_clk", 0, &clk_input_length-1)==STRING.CUT("&clk", -1))
    ( 
      &match=1
    )
  )	  
  else if ("gcc_blsp1_ahb_clk"=="&clk")
  (
    &match=1
  )
  
  if (&match==1)
  (
    &clk_test=&CLK_TEST_GCC_BLSP1_AHB_CLK
    &clk_reg=&HWIO_GCC_BLSP1_AHB_CBCR_ADDR
    &clk_reg_name="GCC_BLSP1_AHB_CBCR"
    &clk_name="gcc_blsp1_ahb_clk"
    &clk_reg_cbcr_type="sm_pscbc"

    gosub Print_Clk_Info_Line
  )
  
  &match=0
  &wild_head=0
  &wild_tail=0
  &clk_input_length=STRING.LENGTH("&clk")
  &clk_itr_length=STRING.LENGTH("gcc_blsp1_sleep_clk")

  if (STRING.SCAN("&clk", "*", 0)==0)
  (
    &wild_head=1
  )
  if (STRING.SCAN("&clk", "*", 1)==(STRING.LENGTH("&clk")-1))
  (
    &wild_tail=1
  )

  if ((&wild_head==1)&&(&wild_tail==1))
  (
    if (STRING.SCAN("gcc_blsp1_sleep_clk", STRING.MID("&clk", 1, &clk_input_length-2), 0)!=-1)
    ( 
      &match=1
    )
  )
  else if (&wild_head==1)
  (
    if (STRING.MID("gcc_blsp1_sleep_clk", &clk_itr_length-&clk_input_length+1, &clk_input_length-1)==STRING.CUT("&clk", 1))
    ( 
      &match=1
    )
  )
  else if (&wild_tail==1)
  (
    if (STRING.MID("gcc_blsp1_sleep_clk", 0, &clk_input_length-1)==STRING.CUT("&clk", -1))
    ( 
      &match=1
    )
  )	  
  else if ("gcc_blsp1_sleep_clk"=="&clk")
  (
    &match=1
  )
  
  if (&match==1)
  (
    &clk_test=&CLK_TEST_GCC_BLSP1_SLEEP_CLK
    &clk_reg=&HWIO_GCC_BLSP1_SLEEP_CBCR_ADDR
    &clk_reg_name="GCC_BLSP1_SLEEP_CBCR"
    &clk_name="gcc_blsp1_sleep_clk"
    &clk_reg_cbcr_type="sm_cbc"

    gosub Print_Clk_Info_Line
  )
  
  &match=0
  &wild_head=0
  &wild_tail=0
  &clk_input_length=STRING.LENGTH("&clk")
  &clk_itr_length=STRING.LENGTH("gcc_blsp1_qup1_i2c_apps_clk")

  if (STRING.SCAN("&clk", "*", 0)==0)
  (
    &wild_head=1
  )
  if (STRING.SCAN("&clk", "*", 1)==(STRING.LENGTH("&clk")-1))
  (
    &wild_tail=1
  )

  if ((&wild_head==1)&&(&wild_tail==1))
  (
    if (STRING.SCAN("gcc_blsp1_qup1_i2c_apps_clk", STRING.MID("&clk", 1, &clk_input_length-2), 0)!=-1)
    ( 
      &match=1
    )
  )
  else if (&wild_head==1)
  (
    if (STRING.MID("gcc_blsp1_qup1_i2c_apps_clk", &clk_itr_length-&clk_input_length+1, &clk_input_length-1)==STRING.CUT("&clk", 1))
    ( 
      &match=1
    )
  )
  else if (&wild_tail==1)
  (
    if (STRING.MID("gcc_blsp1_qup1_i2c_apps_clk", 0, &clk_input_length-1)==STRING.CUT("&clk", -1))
    ( 
      &match=1
    )
  )	  
  else if ("gcc_blsp1_qup1_i2c_apps_clk"=="&clk")
  (
    &match=1
  )
  
  if (&match==1)
  (
    &clk_test=&CLK_TEST_GCC_BLSP1_QUP1_I2C_APPS_CLK
    &clk_reg=&HWIO_GCC_BLSP1_QUP1_I2C_APPS_CBCR_ADDR
    &clk_reg_name="GCC_BLSP1_QUP1_I2C_APPS_CBCR"
    &clk_name="gcc_blsp1_qup1_i2c_apps_clk"
    &clk_reg_cbcr_type="sm_cbc"

    gosub Print_Clk_Info_Line
  )
  
  &match=0
  &wild_head=0
  &wild_tail=0
  &clk_input_length=STRING.LENGTH("&clk")
  &clk_itr_length=STRING.LENGTH("gcc_blsp1_qup1_spi_apps_clk")

  if (STRING.SCAN("&clk", "*", 0)==0)
  (
    &wild_head=1
  )
  if (STRING.SCAN("&clk", "*", 1)==(STRING.LENGTH("&clk")-1))
  (
    &wild_tail=1
  )

  if ((&wild_head==1)&&(&wild_tail==1))
  (
    if (STRING.SCAN("gcc_blsp1_qup1_spi_apps_clk", STRING.MID("&clk", 1, &clk_input_length-2), 0)!=-1)
    ( 
      &match=1
    )
  )
  else if (&wild_head==1)
  (
    if (STRING.MID("gcc_blsp1_qup1_spi_apps_clk", &clk_itr_length-&clk_input_length+1, &clk_input_length-1)==STRING.CUT("&clk", 1))
    ( 
      &match=1
    )
  )
  else if (&wild_tail==1)
  (
    if (STRING.MID("gcc_blsp1_qup1_spi_apps_clk", 0, &clk_input_length-1)==STRING.CUT("&clk", -1))
    ( 
      &match=1
    )
  )	  
  else if ("gcc_blsp1_qup1_spi_apps_clk"=="&clk")
  (
    &match=1
  )
  
  if (&match==1)
  (
    &clk_test=&CLK_TEST_GCC_BLSP1_QUP1_SPI_APPS_CLK
    &clk_reg=&HWIO_GCC_BLSP1_QUP1_SPI_APPS_CBCR_ADDR
    &clk_reg_name="GCC_BLSP1_QUP1_SPI_APPS_CBCR"
    &clk_name="gcc_blsp1_qup1_spi_apps_clk"
    &clk_reg_cbcr_type="sm_cbc"

    gosub Print_Clk_Info_Line
  )
  
  &match=0
  &wild_head=0
  &wild_tail=0
  &clk_input_length=STRING.LENGTH("&clk")
  &clk_itr_length=STRING.LENGTH("gcc_blsp1_qup2_i2c_apps_clk")

  if (STRING.SCAN("&clk", "*", 0)==0)
  (
    &wild_head=1
  )
  if (STRING.SCAN("&clk", "*", 1)==(STRING.LENGTH("&clk")-1))
  (
    &wild_tail=1
  )

  if ((&wild_head==1)&&(&wild_tail==1))
  (
    if (STRING.SCAN("gcc_blsp1_qup2_i2c_apps_clk", STRING.MID("&clk", 1, &clk_input_length-2), 0)!=-1)
    ( 
      &match=1
    )
  )
  else if (&wild_head==1)
  (
    if (STRING.MID("gcc_blsp1_qup2_i2c_apps_clk", &clk_itr_length-&clk_input_length+1, &clk_input_length-1)==STRING.CUT("&clk", 1))
    ( 
      &match=1
    )
  )
  else if (&wild_tail==1)
  (
    if (STRING.MID("gcc_blsp1_qup2_i2c_apps_clk", 0, &clk_input_length-1)==STRING.CUT("&clk", -1))
    ( 
      &match=1
    )
  )	  
  else if ("gcc_blsp1_qup2_i2c_apps_clk"=="&clk")
  (
    &match=1
  )
  
  if (&match==1)
  (
    &clk_test=&CLK_TEST_GCC_BLSP1_QUP2_I2C_APPS_CLK
    &clk_reg=&HWIO_GCC_BLSP1_QUP2_I2C_APPS_CBCR_ADDR
    &clk_reg_name="GCC_BLSP1_QUP2_I2C_APPS_CBCR"
    &clk_name="gcc_blsp1_qup2_i2c_apps_clk"
    &clk_reg_cbcr_type="sm_cbc"

    gosub Print_Clk_Info_Line
  )
  
  &match=0
  &wild_head=0
  &wild_tail=0
  &clk_input_length=STRING.LENGTH("&clk")
  &clk_itr_length=STRING.LENGTH("gcc_blsp1_qup2_spi_apps_clk")

  if (STRING.SCAN("&clk", "*", 0)==0)
  (
    &wild_head=1
  )
  if (STRING.SCAN("&clk", "*", 1)==(STRING.LENGTH("&clk")-1))
  (
    &wild_tail=1
  )

  if ((&wild_head==1)&&(&wild_tail==1))
  (
    if (STRING.SCAN("gcc_blsp1_qup2_spi_apps_clk", STRING.MID("&clk", 1, &clk_input_length-2), 0)!=-1)
    ( 
      &match=1
    )
  )
  else if (&wild_head==1)
  (
    if (STRING.MID("gcc_blsp1_qup2_spi_apps_clk", &clk_itr_length-&clk_input_length+1, &clk_input_length-1)==STRING.CUT("&clk", 1))
    ( 
      &match=1
    )
  )
  else if (&wild_tail==1)
  (
    if (STRING.MID("gcc_blsp1_qup2_spi_apps_clk", 0, &clk_input_length-1)==STRING.CUT("&clk", -1))
    ( 
      &match=1
    )
  )	  
  else if ("gcc_blsp1_qup2_spi_apps_clk"=="&clk")
  (
    &match=1
  )
  
  if (&match==1)
  (
    &clk_test=&CLK_TEST_GCC_BLSP1_QUP2_SPI_APPS_CLK
    &clk_reg=&HWIO_GCC_BLSP1_QUP2_SPI_APPS_CBCR_ADDR
    &clk_reg_name="GCC_BLSP1_QUP2_SPI_APPS_CBCR"
    &clk_name="gcc_blsp1_qup2_spi_apps_clk"
    &clk_reg_cbcr_type="sm_cbc"

    gosub Print_Clk_Info_Line
  )
  
  &match=0
  &wild_head=0
  &wild_tail=0
  &clk_input_length=STRING.LENGTH("&clk")
  &clk_itr_length=STRING.LENGTH("gcc_blsp1_qup3_i2c_apps_clk")

  if (STRING.SCAN("&clk", "*", 0)==0)
  (
    &wild_head=1
  )
  if (STRING.SCAN("&clk", "*", 1)==(STRING.LENGTH("&clk")-1))
  (
    &wild_tail=1
  )

  if ((&wild_head==1)&&(&wild_tail==1))
  (
    if (STRING.SCAN("gcc_blsp1_qup3_i2c_apps_clk", STRING.MID("&clk", 1, &clk_input_length-2), 0)!=-1)
    ( 
      &match=1
    )
  )
  else if (&wild_head==1)
  (
    if (STRING.MID("gcc_blsp1_qup3_i2c_apps_clk", &clk_itr_length-&clk_input_length+1, &clk_input_length-1)==STRING.CUT("&clk", 1))
    ( 
      &match=1
    )
  )
  else if (&wild_tail==1)
  (
    if (STRING.MID("gcc_blsp1_qup3_i2c_apps_clk", 0, &clk_input_length-1)==STRING.CUT("&clk", -1))
    ( 
      &match=1
    )
  )	  
  else if ("gcc_blsp1_qup3_i2c_apps_clk"=="&clk")
  (
    &match=1
  )
  
  if (&match==1)
  (
    &clk_test=&CLK_TEST_GCC_BLSP1_QUP3_I2C_APPS_CLK
    &clk_reg=&HWIO_GCC_BLSP1_QUP3_I2C_APPS_CBCR_ADDR
    &clk_reg_name="GCC_BLSP1_QUP3_I2C_APPS_CBCR"
    &clk_name="gcc_blsp1_qup3_i2c_apps_clk"
    &clk_reg_cbcr_type="sm_cbc"

    gosub Print_Clk_Info_Line
  )
  
  &match=0
  &wild_head=0
  &wild_tail=0
  &clk_input_length=STRING.LENGTH("&clk")
  &clk_itr_length=STRING.LENGTH("gcc_blsp1_qup3_spi_apps_clk")

  if (STRING.SCAN("&clk", "*", 0)==0)
  (
    &wild_head=1
  )
  if (STRING.SCAN("&clk", "*", 1)==(STRING.LENGTH("&clk")-1))
  (
    &wild_tail=1
  )

  if ((&wild_head==1)&&(&wild_tail==1))
  (
    if (STRING.SCAN("gcc_blsp1_qup3_spi_apps_clk", STRING.MID("&clk", 1, &clk_input_length-2), 0)!=-1)
    ( 
      &match=1
    )
  )
  else if (&wild_head==1)
  (
    if (STRING.MID("gcc_blsp1_qup3_spi_apps_clk", &clk_itr_length-&clk_input_length+1, &clk_input_length-1)==STRING.CUT("&clk", 1))
    ( 
      &match=1
    )
  )
  else if (&wild_tail==1)
  (
    if (STRING.MID("gcc_blsp1_qup3_spi_apps_clk", 0, &clk_input_length-1)==STRING.CUT("&clk", -1))
    ( 
      &match=1
    )
  )	  
  else if ("gcc_blsp1_qup3_spi_apps_clk"=="&clk")
  (
    &match=1
  )
  
  if (&match==1)
  (
    &clk_test=&CLK_TEST_GCC_BLSP1_QUP3_SPI_APPS_CLK
    &clk_reg=&HWIO_GCC_BLSP1_QUP3_SPI_APPS_CBCR_ADDR
    &clk_reg_name="GCC_BLSP1_QUP3_SPI_APPS_CBCR"
    &clk_name="gcc_blsp1_qup3_spi_apps_clk"
    &clk_reg_cbcr_type="sm_cbc"

    gosub Print_Clk_Info_Line
  )
  
  &match=0
  &wild_head=0
  &wild_tail=0
  &clk_input_length=STRING.LENGTH("&clk")
  &clk_itr_length=STRING.LENGTH("gcc_blsp1_qup4_i2c_apps_clk")

  if (STRING.SCAN("&clk", "*", 0)==0)
  (
    &wild_head=1
  )
  if (STRING.SCAN("&clk", "*", 1)==(STRING.LENGTH("&clk")-1))
  (
    &wild_tail=1
  )

  if ((&wild_head==1)&&(&wild_tail==1))
  (
    if (STRING.SCAN("gcc_blsp1_qup4_i2c_apps_clk", STRING.MID("&clk", 1, &clk_input_length-2), 0)!=-1)
    ( 
      &match=1
    )
  )
  else if (&wild_head==1)
  (
    if (STRING.MID("gcc_blsp1_qup4_i2c_apps_clk", &clk_itr_length-&clk_input_length+1, &clk_input_length-1)==STRING.CUT("&clk", 1))
    ( 
      &match=1
    )
  )
  else if (&wild_tail==1)
  (
    if (STRING.MID("gcc_blsp1_qup4_i2c_apps_clk", 0, &clk_input_length-1)==STRING.CUT("&clk", -1))
    ( 
      &match=1
    )
  )	  
  else if ("gcc_blsp1_qup4_i2c_apps_clk"=="&clk")
  (
    &match=1
  )
  
  if (&match==1)
  (
    &clk_test=&CLK_TEST_GCC_BLSP1_QUP4_I2C_APPS_CLK
    &clk_reg=&HWIO_GCC_BLSP1_QUP4_I2C_APPS_CBCR_ADDR
    &clk_reg_name="GCC_BLSP1_QUP4_I2C_APPS_CBCR"
    &clk_name="gcc_blsp1_qup4_i2c_apps_clk"
    &clk_reg_cbcr_type="sm_cbc"

    gosub Print_Clk_Info_Line
  )
  
  &match=0
  &wild_head=0
  &wild_tail=0
  &clk_input_length=STRING.LENGTH("&clk")
  &clk_itr_length=STRING.LENGTH("gcc_blsp1_qup4_spi_apps_clk")

  if (STRING.SCAN("&clk", "*", 0)==0)
  (
    &wild_head=1
  )
  if (STRING.SCAN("&clk", "*", 1)==(STRING.LENGTH("&clk")-1))
  (
    &wild_tail=1
  )

  if ((&wild_head==1)&&(&wild_tail==1))
  (
    if (STRING.SCAN("gcc_blsp1_qup4_spi_apps_clk", STRING.MID("&clk", 1, &clk_input_length-2), 0)!=-1)
    ( 
      &match=1
    )
  )
  else if (&wild_head==1)
  (
    if (STRING.MID("gcc_blsp1_qup4_spi_apps_clk", &clk_itr_length-&clk_input_length+1, &clk_input_length-1)==STRING.CUT("&clk", 1))
    ( 
      &match=1
    )
  )
  else if (&wild_tail==1)
  (
    if (STRING.MID("gcc_blsp1_qup4_spi_apps_clk", 0, &clk_input_length-1)==STRING.CUT("&clk", -1))
    ( 
      &match=1
    )
  )	  
  else if ("gcc_blsp1_qup4_spi_apps_clk"=="&clk")
  (
    &match=1
  )
  
  if (&match==1)
  (
    &clk_test=&CLK_TEST_GCC_BLSP1_QUP4_SPI_APPS_CLK
    &clk_reg=&HWIO_GCC_BLSP1_QUP4_SPI_APPS_CBCR_ADDR
    &clk_reg_name="GCC_BLSP1_QUP4_SPI_APPS_CBCR"
    &clk_name="gcc_blsp1_qup4_spi_apps_clk"
    &clk_reg_cbcr_type="sm_cbc"

    gosub Print_Clk_Info_Line
  )
  
  &match=0
  &wild_head=0
  &wild_tail=0
  &clk_input_length=STRING.LENGTH("&clk")
  &clk_itr_length=STRING.LENGTH("gcc_blsp1_qup5_i2c_apps_clk")

  if (STRING.SCAN("&clk", "*", 0)==0)
  (
    &wild_head=1
  )
  if (STRING.SCAN("&clk", "*", 1)==(STRING.LENGTH("&clk")-1))
  (
    &wild_tail=1
  )

  if ((&wild_head==1)&&(&wild_tail==1))
  (
    if (STRING.SCAN("gcc_blsp1_qup5_i2c_apps_clk", STRING.MID("&clk", 1, &clk_input_length-2), 0)!=-1)
    ( 
      &match=1
    )
  )
  else if (&wild_head==1)
  (
    if (STRING.MID("gcc_blsp1_qup5_i2c_apps_clk", &clk_itr_length-&clk_input_length+1, &clk_input_length-1)==STRING.CUT("&clk", 1))
    ( 
      &match=1
    )
  )
  else if (&wild_tail==1)
  (
    if (STRING.MID("gcc_blsp1_qup5_i2c_apps_clk", 0, &clk_input_length-1)==STRING.CUT("&clk", -1))
    ( 
      &match=1
    )
  )	  
  else if ("gcc_blsp1_qup5_i2c_apps_clk"=="&clk")
  (
    &match=1
  )
  
  if (&match==1)
  (
    &clk_test=&CLK_TEST_GCC_BLSP1_QUP5_I2C_APPS_CLK
    &clk_reg=&HWIO_GCC_BLSP1_QUP5_I2C_APPS_CBCR_ADDR
    &clk_reg_name="GCC_BLSP1_QUP5_I2C_APPS_CBCR"
    &clk_name="gcc_blsp1_qup5_i2c_apps_clk"
    &clk_reg_cbcr_type="sm_cbc"

    gosub Print_Clk_Info_Line
  )
  
  &match=0
  &wild_head=0
  &wild_tail=0
  &clk_input_length=STRING.LENGTH("&clk")
  &clk_itr_length=STRING.LENGTH("gcc_blsp1_qup5_spi_apps_clk")

  if (STRING.SCAN("&clk", "*", 0)==0)
  (
    &wild_head=1
  )
  if (STRING.SCAN("&clk", "*", 1)==(STRING.LENGTH("&clk")-1))
  (
    &wild_tail=1
  )

  if ((&wild_head==1)&&(&wild_tail==1))
  (
    if (STRING.SCAN("gcc_blsp1_qup5_spi_apps_clk", STRING.MID("&clk", 1, &clk_input_length-2), 0)!=-1)
    ( 
      &match=1
    )
  )
  else if (&wild_head==1)
  (
    if (STRING.MID("gcc_blsp1_qup5_spi_apps_clk", &clk_itr_length-&clk_input_length+1, &clk_input_length-1)==STRING.CUT("&clk", 1))
    ( 
      &match=1
    )
  )
  else if (&wild_tail==1)
  (
    if (STRING.MID("gcc_blsp1_qup5_spi_apps_clk", 0, &clk_input_length-1)==STRING.CUT("&clk", -1))
    ( 
      &match=1
    )
  )	  
  else if ("gcc_blsp1_qup5_spi_apps_clk"=="&clk")
  (
    &match=1
  )
  
  if (&match==1)
  (
    &clk_test=&CLK_TEST_GCC_BLSP1_QUP5_SPI_APPS_CLK
    &clk_reg=&HWIO_GCC_BLSP1_QUP5_SPI_APPS_CBCR_ADDR
    &clk_reg_name="GCC_BLSP1_QUP5_SPI_APPS_CBCR"
    &clk_name="gcc_blsp1_qup5_spi_apps_clk"
    &clk_reg_cbcr_type="sm_cbc"

    gosub Print_Clk_Info_Line
  )
  
  &match=0
  &wild_head=0
  &wild_tail=0
  &clk_input_length=STRING.LENGTH("&clk")
  &clk_itr_length=STRING.LENGTH("gcc_blsp1_qup6_i2c_apps_clk")

  if (STRING.SCAN("&clk", "*", 0)==0)
  (
    &wild_head=1
  )
  if (STRING.SCAN("&clk", "*", 1)==(STRING.LENGTH("&clk")-1))
  (
    &wild_tail=1
  )

  if ((&wild_head==1)&&(&wild_tail==1))
  (
    if (STRING.SCAN("gcc_blsp1_qup6_i2c_apps_clk", STRING.MID("&clk", 1, &clk_input_length-2), 0)!=-1)
    ( 
      &match=1
    )
  )
  else if (&wild_head==1)
  (
    if (STRING.MID("gcc_blsp1_qup6_i2c_apps_clk", &clk_itr_length-&clk_input_length+1, &clk_input_length-1)==STRING.CUT("&clk", 1))
    ( 
      &match=1
    )
  )
  else if (&wild_tail==1)
  (
    if (STRING.MID("gcc_blsp1_qup6_i2c_apps_clk", 0, &clk_input_length-1)==STRING.CUT("&clk", -1))
    ( 
      &match=1
    )
  )	  
  else if ("gcc_blsp1_qup6_i2c_apps_clk"=="&clk")
  (
    &match=1
  )
  
  if (&match==1)
  (
    &clk_test=&CLK_TEST_GCC_BLSP1_QUP6_I2C_APPS_CLK
    &clk_reg=&HWIO_GCC_BLSP1_QUP6_I2C_APPS_CBCR_ADDR
    &clk_reg_name="GCC_BLSP1_QUP6_I2C_APPS_CBCR"
    &clk_name="gcc_blsp1_qup6_i2c_apps_clk"
    &clk_reg_cbcr_type="sm_cbc"

    gosub Print_Clk_Info_Line
  )
  
  &match=0
  &wild_head=0
  &wild_tail=0
  &clk_input_length=STRING.LENGTH("&clk")
  &clk_itr_length=STRING.LENGTH("gcc_blsp1_qup6_spi_apps_clk")

  if (STRING.SCAN("&clk", "*", 0)==0)
  (
    &wild_head=1
  )
  if (STRING.SCAN("&clk", "*", 1)==(STRING.LENGTH("&clk")-1))
  (
    &wild_tail=1
  )

  if ((&wild_head==1)&&(&wild_tail==1))
  (
    if (STRING.SCAN("gcc_blsp1_qup6_spi_apps_clk", STRING.MID("&clk", 1, &clk_input_length-2), 0)!=-1)
    ( 
      &match=1
    )
  )
  else if (&wild_head==1)
  (
    if (STRING.MID("gcc_blsp1_qup6_spi_apps_clk", &clk_itr_length-&clk_input_length+1, &clk_input_length-1)==STRING.CUT("&clk", 1))
    ( 
      &match=1
    )
  )
  else if (&wild_tail==1)
  (
    if (STRING.MID("gcc_blsp1_qup6_spi_apps_clk", 0, &clk_input_length-1)==STRING.CUT("&clk", -1))
    ( 
      &match=1
    )
  )	  
  else if ("gcc_blsp1_qup6_spi_apps_clk"=="&clk")
  (
    &match=1
  )
  
  if (&match==1)
  (
    &clk_test=&CLK_TEST_GCC_BLSP1_QUP6_SPI_APPS_CLK
    &clk_reg=&HWIO_GCC_BLSP1_QUP6_SPI_APPS_CBCR_ADDR
    &clk_reg_name="GCC_BLSP1_QUP6_SPI_APPS_CBCR"
    &clk_name="gcc_blsp1_qup6_spi_apps_clk"
    &clk_reg_cbcr_type="sm_cbc"

    gosub Print_Clk_Info_Line
  )
  
  &match=0
  &wild_head=0
  &wild_tail=0
  &clk_input_length=STRING.LENGTH("&clk")
  &clk_itr_length=STRING.LENGTH("gcc_blsp1_uart1_apps_clk")

  if (STRING.SCAN("&clk", "*", 0)==0)
  (
    &wild_head=1
  )
  if (STRING.SCAN("&clk", "*", 1)==(STRING.LENGTH("&clk")-1))
  (
    &wild_tail=1
  )

  if ((&wild_head==1)&&(&wild_tail==1))
  (
    if (STRING.SCAN("gcc_blsp1_uart1_apps_clk", STRING.MID("&clk", 1, &clk_input_length-2), 0)!=-1)
    ( 
      &match=1
    )
  )
  else if (&wild_head==1)
  (
    if (STRING.MID("gcc_blsp1_uart1_apps_clk", &clk_itr_length-&clk_input_length+1, &clk_input_length-1)==STRING.CUT("&clk", 1))
    ( 
      &match=1
    )
  )
  else if (&wild_tail==1)
  (
    if (STRING.MID("gcc_blsp1_uart1_apps_clk", 0, &clk_input_length-1)==STRING.CUT("&clk", -1))
    ( 
      &match=1
    )
  )	  
  else if ("gcc_blsp1_uart1_apps_clk"=="&clk")
  (
    &match=1
  )
  
  if (&match==1)
  (
    &clk_test=&CLK_TEST_GCC_BLSP1_UART1_APPS_CLK
    &clk_reg=&HWIO_GCC_BLSP1_UART1_APPS_CBCR_ADDR
    &clk_reg_name="GCC_BLSP1_UART1_APPS_CBCR"
    &clk_name="gcc_blsp1_uart1_apps_clk"
    &clk_reg_cbcr_type="sm_cbc"

    gosub Print_Clk_Info_Line
  )
  
  &match=0
  &wild_head=0
  &wild_tail=0
  &clk_input_length=STRING.LENGTH("&clk")
  &clk_itr_length=STRING.LENGTH("gcc_blsp1_uart1_sim_clk")

  if (STRING.SCAN("&clk", "*", 0)==0)
  (
    &wild_head=1
  )
  if (STRING.SCAN("&clk", "*", 1)==(STRING.LENGTH("&clk")-1))
  (
    &wild_tail=1
  )

  if ((&wild_head==1)&&(&wild_tail==1))
  (
    if (STRING.SCAN("gcc_blsp1_uart1_sim_clk", STRING.MID("&clk", 1, &clk_input_length-2), 0)!=-1)
    ( 
      &match=1
    )
  )
  else if (&wild_head==1)
  (
    if (STRING.MID("gcc_blsp1_uart1_sim_clk", &clk_itr_length-&clk_input_length+1, &clk_input_length-1)==STRING.CUT("&clk", 1))
    ( 
      &match=1
    )
  )
  else if (&wild_tail==1)
  (
    if (STRING.MID("gcc_blsp1_uart1_sim_clk", 0, &clk_input_length-1)==STRING.CUT("&clk", -1))
    ( 
      &match=1
    )
  )	  
  else if ("gcc_blsp1_uart1_sim_clk"=="&clk")
  (
    &match=1
  )
  
  if (&match==1)
  (
    &clk_test=&CLK_TEST_GCC_BLSP1_UART1_SIM_CLK
    &clk_reg=&HWIO_GCC_BLSP1_UART1_SIM_CBCR_ADDR
    &clk_reg_name="GCC_BLSP1_UART1_SIM_CBCR"
    &clk_name="gcc_blsp1_uart1_sim_clk"
    &clk_reg_cbcr_type="sm_cbc"

    gosub Print_Clk_Info_Line
  )
  
  &match=0
  &wild_head=0
  &wild_tail=0
  &clk_input_length=STRING.LENGTH("&clk")
  &clk_itr_length=STRING.LENGTH("gcc_blsp1_uart2_apps_clk")

  if (STRING.SCAN("&clk", "*", 0)==0)
  (
    &wild_head=1
  )
  if (STRING.SCAN("&clk", "*", 1)==(STRING.LENGTH("&clk")-1))
  (
    &wild_tail=1
  )

  if ((&wild_head==1)&&(&wild_tail==1))
  (
    if (STRING.SCAN("gcc_blsp1_uart2_apps_clk", STRING.MID("&clk", 1, &clk_input_length-2), 0)!=-1)
    ( 
      &match=1
    )
  )
  else if (&wild_head==1)
  (
    if (STRING.MID("gcc_blsp1_uart2_apps_clk", &clk_itr_length-&clk_input_length+1, &clk_input_length-1)==STRING.CUT("&clk", 1))
    ( 
      &match=1
    )
  )
  else if (&wild_tail==1)
  (
    if (STRING.MID("gcc_blsp1_uart2_apps_clk", 0, &clk_input_length-1)==STRING.CUT("&clk", -1))
    ( 
      &match=1
    )
  )	  
  else if ("gcc_blsp1_uart2_apps_clk"=="&clk")
  (
    &match=1
  )
  
  if (&match==1)
  (
    &clk_test=&CLK_TEST_GCC_BLSP1_UART2_APPS_CLK
    &clk_reg=&HWIO_GCC_BLSP1_UART2_APPS_CBCR_ADDR
    &clk_reg_name="GCC_BLSP1_UART2_APPS_CBCR"
    &clk_name="gcc_blsp1_uart2_apps_clk"
    &clk_reg_cbcr_type="sm_cbc"

    gosub Print_Clk_Info_Line
  )
  
  &match=0
  &wild_head=0
  &wild_tail=0
  &clk_input_length=STRING.LENGTH("&clk")
  &clk_itr_length=STRING.LENGTH("gcc_blsp1_uart2_sim_clk")

  if (STRING.SCAN("&clk", "*", 0)==0)
  (
    &wild_head=1
  )
  if (STRING.SCAN("&clk", "*", 1)==(STRING.LENGTH("&clk")-1))
  (
    &wild_tail=1
  )

  if ((&wild_head==1)&&(&wild_tail==1))
  (
    if (STRING.SCAN("gcc_blsp1_uart2_sim_clk", STRING.MID("&clk", 1, &clk_input_length-2), 0)!=-1)
    ( 
      &match=1
    )
  )
  else if (&wild_head==1)
  (
    if (STRING.MID("gcc_blsp1_uart2_sim_clk", &clk_itr_length-&clk_input_length+1, &clk_input_length-1)==STRING.CUT("&clk", 1))
    ( 
      &match=1
    )
  )
  else if (&wild_tail==1)
  (
    if (STRING.MID("gcc_blsp1_uart2_sim_clk", 0, &clk_input_length-1)==STRING.CUT("&clk", -1))
    ( 
      &match=1
    )
  )	  
  else if ("gcc_blsp1_uart2_sim_clk"=="&clk")
  (
    &match=1
  )
  
  if (&match==1)
  (
    &clk_test=&CLK_TEST_GCC_BLSP1_UART2_SIM_CLK
    &clk_reg=&HWIO_GCC_BLSP1_UART2_SIM_CBCR_ADDR
    &clk_reg_name="GCC_BLSP1_UART2_SIM_CBCR"
    &clk_name="gcc_blsp1_uart2_sim_clk"
    &clk_reg_cbcr_type="sm_cbc"

    gosub Print_Clk_Info_Line
  )
  
  &match=0
  &wild_head=0
  &wild_tail=0
  &clk_input_length=STRING.LENGTH("&clk")
  &clk_itr_length=STRING.LENGTH("gcc_boot_rom_ahb_clk")

  if (STRING.SCAN("&clk", "*", 0)==0)
  (
    &wild_head=1
  )
  if (STRING.SCAN("&clk", "*", 1)==(STRING.LENGTH("&clk")-1))
  (
    &wild_tail=1
  )

  if ((&wild_head==1)&&(&wild_tail==1))
  (
    if (STRING.SCAN("gcc_boot_rom_ahb_clk", STRING.MID("&clk", 1, &clk_input_length-2), 0)!=-1)
    ( 
      &match=1
    )
  )
  else if (&wild_head==1)
  (
    if (STRING.MID("gcc_boot_rom_ahb_clk", &clk_itr_length-&clk_input_length+1, &clk_input_length-1)==STRING.CUT("&clk", 1))
    ( 
      &match=1
    )
  )
  else if (&wild_tail==1)
  (
    if (STRING.MID("gcc_boot_rom_ahb_clk", 0, &clk_input_length-1)==STRING.CUT("&clk", -1))
    ( 
      &match=1
    )
  )	  
  else if ("gcc_boot_rom_ahb_clk"=="&clk")
  (
    &match=1
  )
  
  if (&match==1)
  (
    &clk_test=&CLK_TEST_GCC_BOOT_ROM_AHB_CLK
    &clk_reg=&HWIO_GCC_BOOT_ROM_AHB_CBCR_ADDR
    &clk_reg_name="GCC_BOOT_ROM_AHB_CBCR"
    &clk_name="gcc_boot_rom_ahb_clk"
    &clk_reg_cbcr_type="sm_pscbc"

    gosub Print_Clk_Info_Line
  )
  
  &match=0
  &wild_head=0
  &wild_tail=0
  &clk_input_length=STRING.LENGTH("&clk")
  &clk_itr_length=STRING.LENGTH("gcc_camss_csi0_ahb_clk")

  if (STRING.SCAN("&clk", "*", 0)==0)
  (
    &wild_head=1
  )
  if (STRING.SCAN("&clk", "*", 1)==(STRING.LENGTH("&clk")-1))
  (
    &wild_tail=1
  )

  if ((&wild_head==1)&&(&wild_tail==1))
  (
    if (STRING.SCAN("gcc_camss_csi0_ahb_clk", STRING.MID("&clk", 1, &clk_input_length-2), 0)!=-1)
    ( 
      &match=1
    )
  )
  else if (&wild_head==1)
  (
    if (STRING.MID("gcc_camss_csi0_ahb_clk", &clk_itr_length-&clk_input_length+1, &clk_input_length-1)==STRING.CUT("&clk", 1))
    ( 
      &match=1
    )
  )
  else if (&wild_tail==1)
  (
    if (STRING.MID("gcc_camss_csi0_ahb_clk", 0, &clk_input_length-1)==STRING.CUT("&clk", -1))
    ( 
      &match=1
    )
  )	  
  else if ("gcc_camss_csi0_ahb_clk"=="&clk")
  (
    &match=1
  )
  
  if (&match==1)
  (
    &clk_test=&CLK_TEST_GCC_CAMSS_CSI0_AHB_CLK
    &clk_reg=&HWIO_GCC_CAMSS_CSI0_AHB_CBCR_ADDR
    &clk_reg_name="GCC_CAMSS_CSI0_AHB_CBCR"
    &clk_name="gcc_camss_csi0_ahb_clk"
    &clk_reg_cbcr_type="sm_cbc"

    gosub Print_Clk_Info_Line
  )
  
  &match=0
  &wild_head=0
  &wild_tail=0
  &clk_input_length=STRING.LENGTH("&clk")
  &clk_itr_length=STRING.LENGTH("gcc_camss_csi0_clk")

  if (STRING.SCAN("&clk", "*", 0)==0)
  (
    &wild_head=1
  )
  if (STRING.SCAN("&clk", "*", 1)==(STRING.LENGTH("&clk")-1))
  (
    &wild_tail=1
  )

  if ((&wild_head==1)&&(&wild_tail==1))
  (
    if (STRING.SCAN("gcc_camss_csi0_clk", STRING.MID("&clk", 1, &clk_input_length-2), 0)!=-1)
    ( 
      &match=1
    )
  )
  else if (&wild_head==1)
  (
    if (STRING.MID("gcc_camss_csi0_clk", &clk_itr_length-&clk_input_length+1, &clk_input_length-1)==STRING.CUT("&clk", 1))
    ( 
      &match=1
    )
  )
  else if (&wild_tail==1)
  (
    if (STRING.MID("gcc_camss_csi0_clk", 0, &clk_input_length-1)==STRING.CUT("&clk", -1))
    ( 
      &match=1
    )
  )	  
  else if ("gcc_camss_csi0_clk"=="&clk")
  (
    &match=1
  )
  
  if (&match==1)
  (
    &clk_test=&CLK_TEST_GCC_CAMSS_CSI0_CLK
    &clk_reg=&HWIO_GCC_CAMSS_CSI0_CBCR_ADDR
    &clk_reg_name="GCC_CAMSS_CSI0_CBCR"
    &clk_name="gcc_camss_csi0_clk"
    &clk_reg_cbcr_type="sm_cbc"

    gosub Print_Clk_Info_Line
  )
  
  &match=0
  &wild_head=0
  &wild_tail=0
  &clk_input_length=STRING.LENGTH("&clk")
  &clk_itr_length=STRING.LENGTH("gcc_camss_csi0phy_clk")

  if (STRING.SCAN("&clk", "*", 0)==0)
  (
    &wild_head=1
  )
  if (STRING.SCAN("&clk", "*", 1)==(STRING.LENGTH("&clk")-1))
  (
    &wild_tail=1
  )

  if ((&wild_head==1)&&(&wild_tail==1))
  (
    if (STRING.SCAN("gcc_camss_csi0phy_clk", STRING.MID("&clk", 1, &clk_input_length-2), 0)!=-1)
    ( 
      &match=1
    )
  )
  else if (&wild_head==1)
  (
    if (STRING.MID("gcc_camss_csi0phy_clk", &clk_itr_length-&clk_input_length+1, &clk_input_length-1)==STRING.CUT("&clk", 1))
    ( 
      &match=1
    )
  )
  else if (&wild_tail==1)
  (
    if (STRING.MID("gcc_camss_csi0phy_clk", 0, &clk_input_length-1)==STRING.CUT("&clk", -1))
    ( 
      &match=1
    )
  )	  
  else if ("gcc_camss_csi0phy_clk"=="&clk")
  (
    &match=1
  )
  
  if (&match==1)
  (
    &clk_test=&CLK_TEST_GCC_CAMSS_CSI0PHY_CLK
    &clk_reg=&HWIO_GCC_CAMSS_CSI0PHY_CBCR_ADDR
    &clk_reg_name="GCC_CAMSS_CSI0PHY_CBCR"
    &clk_name="gcc_camss_csi0phy_clk"
    &clk_reg_cbcr_type="sm_cbc"

    gosub Print_Clk_Info_Line
  )
  
  &match=0
  &wild_head=0
  &wild_tail=0
  &clk_input_length=STRING.LENGTH("&clk")
  &clk_itr_length=STRING.LENGTH("gcc_camss_csi0pix_clk")

  if (STRING.SCAN("&clk", "*", 0)==0)
  (
    &wild_head=1
  )
  if (STRING.SCAN("&clk", "*", 1)==(STRING.LENGTH("&clk")-1))
  (
    &wild_tail=1
  )

  if ((&wild_head==1)&&(&wild_tail==1))
  (
    if (STRING.SCAN("gcc_camss_csi0pix_clk", STRING.MID("&clk", 1, &clk_input_length-2), 0)!=-1)
    ( 
      &match=1
    )
  )
  else if (&wild_head==1)
  (
    if (STRING.MID("gcc_camss_csi0pix_clk", &clk_itr_length-&clk_input_length+1, &clk_input_length-1)==STRING.CUT("&clk", 1))
    ( 
      &match=1
    )
  )
  else if (&wild_tail==1)
  (
    if (STRING.MID("gcc_camss_csi0pix_clk", 0, &clk_input_length-1)==STRING.CUT("&clk", -1))
    ( 
      &match=1
    )
  )	  
  else if ("gcc_camss_csi0pix_clk"=="&clk")
  (
    &match=1
  )
  
  if (&match==1)
  (
    &clk_test=&CLK_TEST_GCC_CAMSS_CSI0PIX_CLK
    &clk_reg=&HWIO_GCC_CAMSS_CSI0PIX_CBCR_ADDR
    &clk_reg_name="GCC_CAMSS_CSI0PIX_CBCR"
    &clk_name="gcc_camss_csi0pix_clk"
    &clk_reg_cbcr_type="sm_cbc"

    gosub Print_Clk_Info_Line
  )
  
  &match=0
  &wild_head=0
  &wild_tail=0
  &clk_input_length=STRING.LENGTH("&clk")
  &clk_itr_length=STRING.LENGTH("gcc_camss_csi0rdi_clk")

  if (STRING.SCAN("&clk", "*", 0)==0)
  (
    &wild_head=1
  )
  if (STRING.SCAN("&clk", "*", 1)==(STRING.LENGTH("&clk")-1))
  (
    &wild_tail=1
  )

  if ((&wild_head==1)&&(&wild_tail==1))
  (
    if (STRING.SCAN("gcc_camss_csi0rdi_clk", STRING.MID("&clk", 1, &clk_input_length-2), 0)!=-1)
    ( 
      &match=1
    )
  )
  else if (&wild_head==1)
  (
    if (STRING.MID("gcc_camss_csi0rdi_clk", &clk_itr_length-&clk_input_length+1, &clk_input_length-1)==STRING.CUT("&clk", 1))
    ( 
      &match=1
    )
  )
  else if (&wild_tail==1)
  (
    if (STRING.MID("gcc_camss_csi0rdi_clk", 0, &clk_input_length-1)==STRING.CUT("&clk", -1))
    ( 
      &match=1
    )
  )	  
  else if ("gcc_camss_csi0rdi_clk"=="&clk")
  (
    &match=1
  )
  
  if (&match==1)
  (
    &clk_test=&CLK_TEST_GCC_CAMSS_CSI0RDI_CLK
    &clk_reg=&HWIO_GCC_CAMSS_CSI0RDI_CBCR_ADDR
    &clk_reg_name="GCC_CAMSS_CSI0RDI_CBCR"
    &clk_name="gcc_camss_csi0rdi_clk"
    &clk_reg_cbcr_type="sm_cbc"

    gosub Print_Clk_Info_Line
  )
  
  &match=0
  &wild_head=0
  &wild_tail=0
  &clk_input_length=STRING.LENGTH("&clk")
  &clk_itr_length=STRING.LENGTH("gcc_camss_csi1_ahb_clk")

  if (STRING.SCAN("&clk", "*", 0)==0)
  (
    &wild_head=1
  )
  if (STRING.SCAN("&clk", "*", 1)==(STRING.LENGTH("&clk")-1))
  (
    &wild_tail=1
  )

  if ((&wild_head==1)&&(&wild_tail==1))
  (
    if (STRING.SCAN("gcc_camss_csi1_ahb_clk", STRING.MID("&clk", 1, &clk_input_length-2), 0)!=-1)
    ( 
      &match=1
    )
  )
  else if (&wild_head==1)
  (
    if (STRING.MID("gcc_camss_csi1_ahb_clk", &clk_itr_length-&clk_input_length+1, &clk_input_length-1)==STRING.CUT("&clk", 1))
    ( 
      &match=1
    )
  )
  else if (&wild_tail==1)
  (
    if (STRING.MID("gcc_camss_csi1_ahb_clk", 0, &clk_input_length-1)==STRING.CUT("&clk", -1))
    ( 
      &match=1
    )
  )	  
  else if ("gcc_camss_csi1_ahb_clk"=="&clk")
  (
    &match=1
  )
  
  if (&match==1)
  (
    &clk_test=&CLK_TEST_GCC_CAMSS_CSI1_AHB_CLK
    &clk_reg=&HWIO_GCC_CAMSS_CSI1_AHB_CBCR_ADDR
    &clk_reg_name="GCC_CAMSS_CSI1_AHB_CBCR"
    &clk_name="gcc_camss_csi1_ahb_clk"
    &clk_reg_cbcr_type="sm_cbc"

    gosub Print_Clk_Info_Line
  )
  
  &match=0
  &wild_head=0
  &wild_tail=0
  &clk_input_length=STRING.LENGTH("&clk")
  &clk_itr_length=STRING.LENGTH("gcc_camss_csi1_clk")

  if (STRING.SCAN("&clk", "*", 0)==0)
  (
    &wild_head=1
  )
  if (STRING.SCAN("&clk", "*", 1)==(STRING.LENGTH("&clk")-1))
  (
    &wild_tail=1
  )

  if ((&wild_head==1)&&(&wild_tail==1))
  (
    if (STRING.SCAN("gcc_camss_csi1_clk", STRING.MID("&clk", 1, &clk_input_length-2), 0)!=-1)
    ( 
      &match=1
    )
  )
  else if (&wild_head==1)
  (
    if (STRING.MID("gcc_camss_csi1_clk", &clk_itr_length-&clk_input_length+1, &clk_input_length-1)==STRING.CUT("&clk", 1))
    ( 
      &match=1
    )
  )
  else if (&wild_tail==1)
  (
    if (STRING.MID("gcc_camss_csi1_clk", 0, &clk_input_length-1)==STRING.CUT("&clk", -1))
    ( 
      &match=1
    )
  )	  
  else if ("gcc_camss_csi1_clk"=="&clk")
  (
    &match=1
  )
  
  if (&match==1)
  (
    &clk_test=&CLK_TEST_GCC_CAMSS_CSI1_CLK
    &clk_reg=&HWIO_GCC_CAMSS_CSI1_CBCR_ADDR
    &clk_reg_name="GCC_CAMSS_CSI1_CBCR"
    &clk_name="gcc_camss_csi1_clk"
    &clk_reg_cbcr_type="sm_cbc"

    gosub Print_Clk_Info_Line
  )
  
  &match=0
  &wild_head=0
  &wild_tail=0
  &clk_input_length=STRING.LENGTH("&clk")
  &clk_itr_length=STRING.LENGTH("gcc_camss_csi1phy_clk")

  if (STRING.SCAN("&clk", "*", 0)==0)
  (
    &wild_head=1
  )
  if (STRING.SCAN("&clk", "*", 1)==(STRING.LENGTH("&clk")-1))
  (
    &wild_tail=1
  )

  if ((&wild_head==1)&&(&wild_tail==1))
  (
    if (STRING.SCAN("gcc_camss_csi1phy_clk", STRING.MID("&clk", 1, &clk_input_length-2), 0)!=-1)
    ( 
      &match=1
    )
  )
  else if (&wild_head==1)
  (
    if (STRING.MID("gcc_camss_csi1phy_clk", &clk_itr_length-&clk_input_length+1, &clk_input_length-1)==STRING.CUT("&clk", 1))
    ( 
      &match=1
    )
  )
  else if (&wild_tail==1)
  (
    if (STRING.MID("gcc_camss_csi1phy_clk", 0, &clk_input_length-1)==STRING.CUT("&clk", -1))
    ( 
      &match=1
    )
  )	  
  else if ("gcc_camss_csi1phy_clk"=="&clk")
  (
    &match=1
  )
  
  if (&match==1)
  (
    &clk_test=&CLK_TEST_GCC_CAMSS_CSI1PHY_CLK
    &clk_reg=&HWIO_GCC_CAMSS_CSI1PHY_CBCR_ADDR
    &clk_reg_name="GCC_CAMSS_CSI1PHY_CBCR"
    &clk_name="gcc_camss_csi1phy_clk"
    &clk_reg_cbcr_type="sm_cbc"

    gosub Print_Clk_Info_Line
  )
  
  &match=0
  &wild_head=0
  &wild_tail=0
  &clk_input_length=STRING.LENGTH("&clk")
  &clk_itr_length=STRING.LENGTH("gcc_camss_csi1pix_clk")

  if (STRING.SCAN("&clk", "*", 0)==0)
  (
    &wild_head=1
  )
  if (STRING.SCAN("&clk", "*", 1)==(STRING.LENGTH("&clk")-1))
  (
    &wild_tail=1
  )

  if ((&wild_head==1)&&(&wild_tail==1))
  (
    if (STRING.SCAN("gcc_camss_csi1pix_clk", STRING.MID("&clk", 1, &clk_input_length-2), 0)!=-1)
    ( 
      &match=1
    )
  )
  else if (&wild_head==1)
  (
    if (STRING.MID("gcc_camss_csi1pix_clk", &clk_itr_length-&clk_input_length+1, &clk_input_length-1)==STRING.CUT("&clk", 1))
    ( 
      &match=1
    )
  )
  else if (&wild_tail==1)
  (
    if (STRING.MID("gcc_camss_csi1pix_clk", 0, &clk_input_length-1)==STRING.CUT("&clk", -1))
    ( 
      &match=1
    )
  )	  
  else if ("gcc_camss_csi1pix_clk"=="&clk")
  (
    &match=1
  )
  
  if (&match==1)
  (
    &clk_test=&CLK_TEST_GCC_CAMSS_CSI1PIX_CLK
    &clk_reg=&HWIO_GCC_CAMSS_CSI1PIX_CBCR_ADDR
    &clk_reg_name="GCC_CAMSS_CSI1PIX_CBCR"
    &clk_name="gcc_camss_csi1pix_clk"
    &clk_reg_cbcr_type="sm_cbc"

    gosub Print_Clk_Info_Line
  )
  
  &match=0
  &wild_head=0
  &wild_tail=0
  &clk_input_length=STRING.LENGTH("&clk")
  &clk_itr_length=STRING.LENGTH("gcc_camss_csi1rdi_clk")

  if (STRING.SCAN("&clk", "*", 0)==0)
  (
    &wild_head=1
  )
  if (STRING.SCAN("&clk", "*", 1)==(STRING.LENGTH("&clk")-1))
  (
    &wild_tail=1
  )

  if ((&wild_head==1)&&(&wild_tail==1))
  (
    if (STRING.SCAN("gcc_camss_csi1rdi_clk", STRING.MID("&clk", 1, &clk_input_length-2), 0)!=-1)
    ( 
      &match=1
    )
  )
  else if (&wild_head==1)
  (
    if (STRING.MID("gcc_camss_csi1rdi_clk", &clk_itr_length-&clk_input_length+1, &clk_input_length-1)==STRING.CUT("&clk", 1))
    ( 
      &match=1
    )
  )
  else if (&wild_tail==1)
  (
    if (STRING.MID("gcc_camss_csi1rdi_clk", 0, &clk_input_length-1)==STRING.CUT("&clk", -1))
    ( 
      &match=1
    )
  )	  
  else if ("gcc_camss_csi1rdi_clk"=="&clk")
  (
    &match=1
  )
  
  if (&match==1)
  (
    &clk_test=&CLK_TEST_GCC_CAMSS_CSI1RDI_CLK
    &clk_reg=&HWIO_GCC_CAMSS_CSI1RDI_CBCR_ADDR
    &clk_reg_name="GCC_CAMSS_CSI1RDI_CBCR"
    &clk_name="gcc_camss_csi1rdi_clk"
    &clk_reg_cbcr_type="sm_cbc"

    gosub Print_Clk_Info_Line
  )
  
  &match=0
  &wild_head=0
  &wild_tail=0
  &clk_input_length=STRING.LENGTH("&clk")
  &clk_itr_length=STRING.LENGTH("gcc_camss_csi_vfe0_clk")

  if (STRING.SCAN("&clk", "*", 0)==0)
  (
    &wild_head=1
  )
  if (STRING.SCAN("&clk", "*", 1)==(STRING.LENGTH("&clk")-1))
  (
    &wild_tail=1
  )

  if ((&wild_head==1)&&(&wild_tail==1))
  (
    if (STRING.SCAN("gcc_camss_csi_vfe0_clk", STRING.MID("&clk", 1, &clk_input_length-2), 0)!=-1)
    ( 
      &match=1
    )
  )
  else if (&wild_head==1)
  (
    if (STRING.MID("gcc_camss_csi_vfe0_clk", &clk_itr_length-&clk_input_length+1, &clk_input_length-1)==STRING.CUT("&clk", 1))
    ( 
      &match=1
    )
  )
  else if (&wild_tail==1)
  (
    if (STRING.MID("gcc_camss_csi_vfe0_clk", 0, &clk_input_length-1)==STRING.CUT("&clk", -1))
    ( 
      &match=1
    )
  )	  
  else if ("gcc_camss_csi_vfe0_clk"=="&clk")
  (
    &match=1
  )
  
  if (&match==1)
  (
    &clk_test=&CLK_TEST_GCC_CAMSS_CSI_VFE0_CLK
    &clk_reg=&HWIO_GCC_CAMSS_CSI_VFE0_CBCR_ADDR
    &clk_reg_name="GCC_CAMSS_CSI_VFE0_CBCR"
    &clk_name="gcc_camss_csi_vfe0_clk"
    &clk_reg_cbcr_type="sm_pscbc"

    gosub Print_Clk_Info_Line
  )
  
  &match=0
  &wild_head=0
  &wild_tail=0
  &clk_input_length=STRING.LENGTH("&clk")
  &clk_itr_length=STRING.LENGTH("gcc_camss_gp0_clk")

  if (STRING.SCAN("&clk", "*", 0)==0)
  (
    &wild_head=1
  )
  if (STRING.SCAN("&clk", "*", 1)==(STRING.LENGTH("&clk")-1))
  (
    &wild_tail=1
  )

  if ((&wild_head==1)&&(&wild_tail==1))
  (
    if (STRING.SCAN("gcc_camss_gp0_clk", STRING.MID("&clk", 1, &clk_input_length-2), 0)!=-1)
    ( 
      &match=1
    )
  )
  else if (&wild_head==1)
  (
    if (STRING.MID("gcc_camss_gp0_clk", &clk_itr_length-&clk_input_length+1, &clk_input_length-1)==STRING.CUT("&clk", 1))
    ( 
      &match=1
    )
  )
  else if (&wild_tail==1)
  (
    if (STRING.MID("gcc_camss_gp0_clk", 0, &clk_input_length-1)==STRING.CUT("&clk", -1))
    ( 
      &match=1
    )
  )	  
  else if ("gcc_camss_gp0_clk"=="&clk")
  (
    &match=1
  )
  
  if (&match==1)
  (
    &clk_test=&CLK_TEST_GCC_CAMSS_GP0_CLK
    &clk_reg=&HWIO_GCC_CAMSS_GP0_CBCR_ADDR
    &clk_reg_name="GCC_CAMSS_GP0_CBCR"
    &clk_name="gcc_camss_gp0_clk"
    &clk_reg_cbcr_type="sm_cbc"

    gosub Print_Clk_Info_Line
  )
  
  &match=0
  &wild_head=0
  &wild_tail=0
  &clk_input_length=STRING.LENGTH("&clk")
  &clk_itr_length=STRING.LENGTH("gcc_camss_gp1_clk")

  if (STRING.SCAN("&clk", "*", 0)==0)
  (
    &wild_head=1
  )
  if (STRING.SCAN("&clk", "*", 1)==(STRING.LENGTH("&clk")-1))
  (
    &wild_tail=1
  )

  if ((&wild_head==1)&&(&wild_tail==1))
  (
    if (STRING.SCAN("gcc_camss_gp1_clk", STRING.MID("&clk", 1, &clk_input_length-2), 0)!=-1)
    ( 
      &match=1
    )
  )
  else if (&wild_head==1)
  (
    if (STRING.MID("gcc_camss_gp1_clk", &clk_itr_length-&clk_input_length+1, &clk_input_length-1)==STRING.CUT("&clk", 1))
    ( 
      &match=1
    )
  )
  else if (&wild_tail==1)
  (
    if (STRING.MID("gcc_camss_gp1_clk", 0, &clk_input_length-1)==STRING.CUT("&clk", -1))
    ( 
      &match=1
    )
  )	  
  else if ("gcc_camss_gp1_clk"=="&clk")
  (
    &match=1
  )
  
  if (&match==1)
  (
    &clk_test=&CLK_TEST_GCC_CAMSS_GP1_CLK
    &clk_reg=&HWIO_GCC_CAMSS_GP1_CBCR_ADDR
    &clk_reg_name="GCC_CAMSS_GP1_CBCR"
    &clk_name="gcc_camss_gp1_clk"
    &clk_reg_cbcr_type="sm_cbc"

    gosub Print_Clk_Info_Line
  )
  
  &match=0
  &wild_head=0
  &wild_tail=0
  &clk_input_length=STRING.LENGTH("&clk")
  &clk_itr_length=STRING.LENGTH("gcc_camss_ispif_ahb_clk")

  if (STRING.SCAN("&clk", "*", 0)==0)
  (
    &wild_head=1
  )
  if (STRING.SCAN("&clk", "*", 1)==(STRING.LENGTH("&clk")-1))
  (
    &wild_tail=1
  )

  if ((&wild_head==1)&&(&wild_tail==1))
  (
    if (STRING.SCAN("gcc_camss_ispif_ahb_clk", STRING.MID("&clk", 1, &clk_input_length-2), 0)!=-1)
    ( 
      &match=1
    )
  )
  else if (&wild_head==1)
  (
    if (STRING.MID("gcc_camss_ispif_ahb_clk", &clk_itr_length-&clk_input_length+1, &clk_input_length-1)==STRING.CUT("&clk", 1))
    ( 
      &match=1
    )
  )
  else if (&wild_tail==1)
  (
    if (STRING.MID("gcc_camss_ispif_ahb_clk", 0, &clk_input_length-1)==STRING.CUT("&clk", -1))
    ( 
      &match=1
    )
  )	  
  else if ("gcc_camss_ispif_ahb_clk"=="&clk")
  (
    &match=1
  )
  
  if (&match==1)
  (
    &clk_test=&CLK_TEST_GCC_CAMSS_ISPIF_AHB_CLK
    &clk_reg=&HWIO_GCC_CAMSS_ISPIF_AHB_CBCR_ADDR
    &clk_reg_name="GCC_CAMSS_ISPIF_AHB_CBCR"
    &clk_name="gcc_camss_ispif_ahb_clk"
    &clk_reg_cbcr_type="sm_cbc"

    gosub Print_Clk_Info_Line
  )
  
  &match=0
  &wild_head=0
  &wild_tail=0
  &clk_input_length=STRING.LENGTH("&clk")
  &clk_itr_length=STRING.LENGTH("gcc_camss_mclk0_clk")

  if (STRING.SCAN("&clk", "*", 0)==0)
  (
    &wild_head=1
  )
  if (STRING.SCAN("&clk", "*", 1)==(STRING.LENGTH("&clk")-1))
  (
    &wild_tail=1
  )

  if ((&wild_head==1)&&(&wild_tail==1))
  (
    if (STRING.SCAN("gcc_camss_mclk0_clk", STRING.MID("&clk", 1, &clk_input_length-2), 0)!=-1)
    ( 
      &match=1
    )
  )
  else if (&wild_head==1)
  (
    if (STRING.MID("gcc_camss_mclk0_clk", &clk_itr_length-&clk_input_length+1, &clk_input_length-1)==STRING.CUT("&clk", 1))
    ( 
      &match=1
    )
  )
  else if (&wild_tail==1)
  (
    if (STRING.MID("gcc_camss_mclk0_clk", 0, &clk_input_length-1)==STRING.CUT("&clk", -1))
    ( 
      &match=1
    )
  )	  
  else if ("gcc_camss_mclk0_clk"=="&clk")
  (
    &match=1
  )
  
  if (&match==1)
  (
    &clk_test=&CLK_TEST_GCC_CAMSS_MCLK0_CLK
    &clk_reg=&HWIO_GCC_CAMSS_MCLK0_CBCR_ADDR
    &clk_reg_name="GCC_CAMSS_MCLK0_CBCR"
    &clk_name="gcc_camss_mclk0_clk"
    &clk_reg_cbcr_type="sm_cbc"

    gosub Print_Clk_Info_Line
  )
  
  &match=0
  &wild_head=0
  &wild_tail=0
  &clk_input_length=STRING.LENGTH("&clk")
  &clk_itr_length=STRING.LENGTH("gcc_camss_mclk1_clk")

  if (STRING.SCAN("&clk", "*", 0)==0)
  (
    &wild_head=1
  )
  if (STRING.SCAN("&clk", "*", 1)==(STRING.LENGTH("&clk")-1))
  (
    &wild_tail=1
  )

  if ((&wild_head==1)&&(&wild_tail==1))
  (
    if (STRING.SCAN("gcc_camss_mclk1_clk", STRING.MID("&clk", 1, &clk_input_length-2), 0)!=-1)
    ( 
      &match=1
    )
  )
  else if (&wild_head==1)
  (
    if (STRING.MID("gcc_camss_mclk1_clk", &clk_itr_length-&clk_input_length+1, &clk_input_length-1)==STRING.CUT("&clk", 1))
    ( 
      &match=1
    )
  )
  else if (&wild_tail==1)
  (
    if (STRING.MID("gcc_camss_mclk1_clk", 0, &clk_input_length-1)==STRING.CUT("&clk", -1))
    ( 
      &match=1
    )
  )	  
  else if ("gcc_camss_mclk1_clk"=="&clk")
  (
    &match=1
  )
  
  if (&match==1)
  (
    &clk_test=&CLK_TEST_GCC_CAMSS_MCLK1_CLK
    &clk_reg=&HWIO_GCC_CAMSS_MCLK1_CBCR_ADDR
    &clk_reg_name="GCC_CAMSS_MCLK1_CBCR"
    &clk_name="gcc_camss_mclk1_clk"
    &clk_reg_cbcr_type="sm_cbc"

    gosub Print_Clk_Info_Line
  )
  
  &match=0
  &wild_head=0
  &wild_tail=0
  &clk_input_length=STRING.LENGTH("&clk")
  &clk_itr_length=STRING.LENGTH("gcc_camss_csi0phytimer_clk")

  if (STRING.SCAN("&clk", "*", 0)==0)
  (
    &wild_head=1
  )
  if (STRING.SCAN("&clk", "*", 1)==(STRING.LENGTH("&clk")-1))
  (
    &wild_tail=1
  )

  if ((&wild_head==1)&&(&wild_tail==1))
  (
    if (STRING.SCAN("gcc_camss_csi0phytimer_clk", STRING.MID("&clk", 1, &clk_input_length-2), 0)!=-1)
    ( 
      &match=1
    )
  )
  else if (&wild_head==1)
  (
    if (STRING.MID("gcc_camss_csi0phytimer_clk", &clk_itr_length-&clk_input_length+1, &clk_input_length-1)==STRING.CUT("&clk", 1))
    ( 
      &match=1
    )
  )
  else if (&wild_tail==1)
  (
    if (STRING.MID("gcc_camss_csi0phytimer_clk", 0, &clk_input_length-1)==STRING.CUT("&clk", -1))
    ( 
      &match=1
    )
  )	  
  else if ("gcc_camss_csi0phytimer_clk"=="&clk")
  (
    &match=1
  )
  
  if (&match==1)
  (
    &clk_test=&CLK_TEST_GCC_CAMSS_CSI0PHYTIMER_CLK
    &clk_reg=0
    &clk_reg_name="No CBCR"
    &clk_name="gcc_camss_csi0phytimer_clk"
    &clk_reg_cbcr_type="sm_cbc"

    gosub Print_Clk_Info_Line
  )
  
  &match=0
  &wild_head=0
  &wild_tail=0
  &clk_input_length=STRING.LENGTH("&clk")
  &clk_itr_length=STRING.LENGTH("gcc_camss_ahb_clk")

  if (STRING.SCAN("&clk", "*", 0)==0)
  (
    &wild_head=1
  )
  if (STRING.SCAN("&clk", "*", 1)==(STRING.LENGTH("&clk")-1))
  (
    &wild_tail=1
  )

  if ((&wild_head==1)&&(&wild_tail==1))
  (
    if (STRING.SCAN("gcc_camss_ahb_clk", STRING.MID("&clk", 1, &clk_input_length-2), 0)!=-1)
    ( 
      &match=1
    )
  )
  else if (&wild_head==1)
  (
    if (STRING.MID("gcc_camss_ahb_clk", &clk_itr_length-&clk_input_length+1, &clk_input_length-1)==STRING.CUT("&clk", 1))
    ( 
      &match=1
    )
  )
  else if (&wild_tail==1)
  (
    if (STRING.MID("gcc_camss_ahb_clk", 0, &clk_input_length-1)==STRING.CUT("&clk", -1))
    ( 
      &match=1
    )
  )	  
  else if ("gcc_camss_ahb_clk"=="&clk")
  (
    &match=1
  )
  
  if (&match==1)
  (
    &clk_test=&CLK_TEST_GCC_CAMSS_AHB_CLK
    &clk_reg=&HWIO_GCC_CAMSS_AHB_CBCR_ADDR
    &clk_reg_name="GCC_CAMSS_AHB_CBCR"
    &clk_name="gcc_camss_ahb_clk"
    &clk_reg_cbcr_type="sm_cbc"

    gosub Print_Clk_Info_Line
  )
  
  &match=0
  &wild_head=0
  &wild_tail=0
  &clk_input_length=STRING.LENGTH("&clk")
  &clk_itr_length=STRING.LENGTH("gcc_camss_top_ahb_clk")

  if (STRING.SCAN("&clk", "*", 0)==0)
  (
    &wild_head=1
  )
  if (STRING.SCAN("&clk", "*", 1)==(STRING.LENGTH("&clk")-1))
  (
    &wild_tail=1
  )

  if ((&wild_head==1)&&(&wild_tail==1))
  (
    if (STRING.SCAN("gcc_camss_top_ahb_clk", STRING.MID("&clk", 1, &clk_input_length-2), 0)!=-1)
    ( 
      &match=1
    )
  )
  else if (&wild_head==1)
  (
    if (STRING.MID("gcc_camss_top_ahb_clk", &clk_itr_length-&clk_input_length+1, &clk_input_length-1)==STRING.CUT("&clk", 1))
    ( 
      &match=1
    )
  )
  else if (&wild_tail==1)
  (
    if (STRING.MID("gcc_camss_top_ahb_clk", 0, &clk_input_length-1)==STRING.CUT("&clk", -1))
    ( 
      &match=1
    )
  )	  
  else if ("gcc_camss_top_ahb_clk"=="&clk")
  (
    &match=1
  )
  
  if (&match==1)
  (
    &clk_test=&CLK_TEST_GCC_CAMSS_TOP_AHB_CLK
    &clk_reg=&HWIO_GCC_CAMSS_TOP_AHB_CBCR_ADDR
    &clk_reg_name="GCC_CAMSS_TOP_AHB_CBCR"
    &clk_name="gcc_camss_top_ahb_clk"
    &clk_reg_cbcr_type="sm_cbc"

    gosub Print_Clk_Info_Line
  )
  
  &match=0
  &wild_head=0
  &wild_tail=0
  &clk_input_length=STRING.LENGTH("&clk")
  &clk_itr_length=STRING.LENGTH("gcc_camss_vfe0_clk")

  if (STRING.SCAN("&clk", "*", 0)==0)
  (
    &wild_head=1
  )
  if (STRING.SCAN("&clk", "*", 1)==(STRING.LENGTH("&clk")-1))
  (
    &wild_tail=1
  )

  if ((&wild_head==1)&&(&wild_tail==1))
  (
    if (STRING.SCAN("gcc_camss_vfe0_clk", STRING.MID("&clk", 1, &clk_input_length-2), 0)!=-1)
    ( 
      &match=1
    )
  )
  else if (&wild_head==1)
  (
    if (STRING.MID("gcc_camss_vfe0_clk", &clk_itr_length-&clk_input_length+1, &clk_input_length-1)==STRING.CUT("&clk", 1))
    ( 
      &match=1
    )
  )
  else if (&wild_tail==1)
  (
    if (STRING.MID("gcc_camss_vfe0_clk", 0, &clk_input_length-1)==STRING.CUT("&clk", -1))
    ( 
      &match=1
    )
  )	  
  else if ("gcc_camss_vfe0_clk"=="&clk")
  (
    &match=1
  )
  
  if (&match==1)
  (
    &clk_test=&CLK_TEST_GCC_CAMSS_VFE0_CLK
    &clk_reg=&HWIO_GCC_CAMSS_VFE0_CBCR_ADDR
    &clk_reg_name="GCC_CAMSS_VFE0_CBCR"
    &clk_name="gcc_camss_vfe0_clk"
    &clk_reg_cbcr_type="gfmux"

    gosub Print_Clk_Info_Line
  )
  
  &match=0
  &wild_head=0
  &wild_tail=0
  &clk_input_length=STRING.LENGTH("&clk")
  &clk_itr_length=STRING.LENGTH("gcc_camss_vfe0_vbif_clk")

  if (STRING.SCAN("&clk", "*", 0)==0)
  (
    &wild_head=1
  )
  if (STRING.SCAN("&clk", "*", 1)==(STRING.LENGTH("&clk")-1))
  (
    &wild_tail=1
  )

  if ((&wild_head==1)&&(&wild_tail==1))
  (
    if (STRING.SCAN("gcc_camss_vfe0_vbif_clk", STRING.MID("&clk", 1, &clk_input_length-2), 0)!=-1)
    ( 
      &match=1
    )
  )
  else if (&wild_head==1)
  (
    if (STRING.MID("gcc_camss_vfe0_vbif_clk", &clk_itr_length-&clk_input_length+1, &clk_input_length-1)==STRING.CUT("&clk", 1))
    ( 
      &match=1
    )
  )
  else if (&wild_tail==1)
  (
    if (STRING.MID("gcc_camss_vfe0_vbif_clk", 0, &clk_input_length-1)==STRING.CUT("&clk", -1))
    ( 
      &match=1
    )
  )	  
  else if ("gcc_camss_vfe0_vbif_clk"=="&clk")
  (
    &match=1
  )
  
  if (&match==1)
  (
    &clk_test=&CLK_TEST_GCC_CAMSS_VFE0_VBIF_CLK
    &clk_reg=0
    &clk_reg_name="No CBCR"
    &clk_name="gcc_camss_vfe0_vbif_clk"
    &clk_reg_cbcr_type="sm_pscbc"

    gosub Print_Clk_Info_Line
  )
  
  &match=0
  &wild_head=0
  &wild_tail=0
  &clk_input_length=STRING.LENGTH("&clk")
  &clk_itr_length=STRING.LENGTH("gcc_camss_vfe_ahb_clk")

  if (STRING.SCAN("&clk", "*", 0)==0)
  (
    &wild_head=1
  )
  if (STRING.SCAN("&clk", "*", 1)==(STRING.LENGTH("&clk")-1))
  (
    &wild_tail=1
  )

  if ((&wild_head==1)&&(&wild_tail==1))
  (
    if (STRING.SCAN("gcc_camss_vfe_ahb_clk", STRING.MID("&clk", 1, &clk_input_length-2), 0)!=-1)
    ( 
      &match=1
    )
  )
  else if (&wild_head==1)
  (
    if (STRING.MID("gcc_camss_vfe_ahb_clk", &clk_itr_length-&clk_input_length+1, &clk_input_length-1)==STRING.CUT("&clk", 1))
    ( 
      &match=1
    )
  )
  else if (&wild_tail==1)
  (
    if (STRING.MID("gcc_camss_vfe_ahb_clk", 0, &clk_input_length-1)==STRING.CUT("&clk", -1))
    ( 
      &match=1
    )
  )	  
  else if ("gcc_camss_vfe_ahb_clk"=="&clk")
  (
    &match=1
  )
  
  if (&match==1)
  (
    &clk_test=&CLK_TEST_GCC_CAMSS_VFE_AHB_CLK
    &clk_reg=&HWIO_GCC_CAMSS_VFE_AHB_CBCR_ADDR
    &clk_reg_name="GCC_CAMSS_VFE_AHB_CBCR"
    &clk_name="gcc_camss_vfe_ahb_clk"
    &clk_reg_cbcr_type="gfmux"

    gosub Print_Clk_Info_Line
  )
  
  &match=0
  &wild_head=0
  &wild_tail=0
  &clk_input_length=STRING.LENGTH("&clk")
  &clk_itr_length=STRING.LENGTH("gcc_camss_vfe_axi_clk")

  if (STRING.SCAN("&clk", "*", 0)==0)
  (
    &wild_head=1
  )
  if (STRING.SCAN("&clk", "*", 1)==(STRING.LENGTH("&clk")-1))
  (
    &wild_tail=1
  )

  if ((&wild_head==1)&&(&wild_tail==1))
  (
    if (STRING.SCAN("gcc_camss_vfe_axi_clk", STRING.MID("&clk", 1, &clk_input_length-2), 0)!=-1)
    ( 
      &match=1
    )
  )
  else if (&wild_head==1)
  (
    if (STRING.MID("gcc_camss_vfe_axi_clk", &clk_itr_length-&clk_input_length+1, &clk_input_length-1)==STRING.CUT("&clk", 1))
    ( 
      &match=1
    )
  )
  else if (&wild_tail==1)
  (
    if (STRING.MID("gcc_camss_vfe_axi_clk", 0, &clk_input_length-1)==STRING.CUT("&clk", -1))
    ( 
      &match=1
    )
  )	  
  else if ("gcc_camss_vfe_axi_clk"=="&clk")
  (
    &match=1
  )
  
  if (&match==1)
  (
    &clk_test=&CLK_TEST_GCC_CAMSS_VFE_AXI_CLK
    &clk_reg=&HWIO_GCC_CAMSS_VFE_AXI_CBCR_ADDR
    &clk_reg_name="GCC_CAMSS_VFE_AXI_CBCR"
    &clk_name="gcc_camss_vfe_axi_clk"
    &clk_reg_cbcr_type="sm_pscbc"

    gosub Print_Clk_Info_Line
  )
  
  &match=0
  &wild_head=0
  &wild_tail=0
  &clk_input_length=STRING.LENGTH("&clk")
  &clk_itr_length=STRING.LENGTH("gcc_camss_vfe_vbif_ahb_clk")

  if (STRING.SCAN("&clk", "*", 0)==0)
  (
    &wild_head=1
  )
  if (STRING.SCAN("&clk", "*", 1)==(STRING.LENGTH("&clk")-1))
  (
    &wild_tail=1
  )

  if ((&wild_head==1)&&(&wild_tail==1))
  (
    if (STRING.SCAN("gcc_camss_vfe_vbif_ahb_clk", STRING.MID("&clk", 1, &clk_input_length-2), 0)!=-1)
    ( 
      &match=1
    )
  )
  else if (&wild_head==1)
  (
    if (STRING.MID("gcc_camss_vfe_vbif_ahb_clk", &clk_itr_length-&clk_input_length+1, &clk_input_length-1)==STRING.CUT("&clk", 1))
    ( 
      &match=1
    )
  )
  else if (&wild_tail==1)
  (
    if (STRING.MID("gcc_camss_vfe_vbif_ahb_clk", 0, &clk_input_length-1)==STRING.CUT("&clk", -1))
    ( 
      &match=1
    )
  )	  
  else if ("gcc_camss_vfe_vbif_ahb_clk"=="&clk")
  (
    &match=1
  )
  
  if (&match==1)
  (
    &clk_test=&CLK_TEST_GCC_CAMSS_VFE_VBIF_AHB_CLK
    &clk_reg=0
    &clk_reg_name="No CBCR"
    &clk_name="gcc_camss_vfe_vbif_ahb_clk"
    &clk_reg_cbcr_type="sm_cbc"

    gosub Print_Clk_Info_Line
  )
  
  &match=0
  &wild_head=0
  &wild_tail=0
  &clk_input_length=STRING.LENGTH("&clk")
  &clk_itr_length=STRING.LENGTH("gcc_vfe_qdss_at_clk")

  if (STRING.SCAN("&clk", "*", 0)==0)
  (
    &wild_head=1
  )
  if (STRING.SCAN("&clk", "*", 1)==(STRING.LENGTH("&clk")-1))
  (
    &wild_tail=1
  )

  if ((&wild_head==1)&&(&wild_tail==1))
  (
    if (STRING.SCAN("gcc_vfe_qdss_at_clk", STRING.MID("&clk", 1, &clk_input_length-2), 0)!=-1)
    ( 
      &match=1
    )
  )
  else if (&wild_head==1)
  (
    if (STRING.MID("gcc_vfe_qdss_at_clk", &clk_itr_length-&clk_input_length+1, &clk_input_length-1)==STRING.CUT("&clk", 1))
    ( 
      &match=1
    )
  )
  else if (&wild_tail==1)
  (
    if (STRING.MID("gcc_vfe_qdss_at_clk", 0, &clk_input_length-1)==STRING.CUT("&clk", -1))
    ( 
      &match=1
    )
  )	  
  else if ("gcc_vfe_qdss_at_clk"=="&clk")
  (
    &match=1
  )
  
  if (&match==1)
  (
    &clk_test=&CLK_TEST_GCC_VFE_QDSS_AT_CLK
    &clk_reg=0
    &clk_reg_name="No CBCR"
    &clk_name="gcc_vfe_qdss_at_clk"
    &clk_reg_cbcr_type="cgc"

    gosub Print_Clk_Info_Line
  )
  
  &match=0
  &wild_head=0
  &wild_tail=0
  &clk_input_length=STRING.LENGTH("&clk")
  &clk_itr_length=STRING.LENGTH("gcc_vfe_qdss_tsctr_div8_clk")

  if (STRING.SCAN("&clk", "*", 0)==0)
  (
    &wild_head=1
  )
  if (STRING.SCAN("&clk", "*", 1)==(STRING.LENGTH("&clk")-1))
  (
    &wild_tail=1
  )

  if ((&wild_head==1)&&(&wild_tail==1))
  (
    if (STRING.SCAN("gcc_vfe_qdss_tsctr_div8_clk", STRING.MID("&clk", 1, &clk_input_length-2), 0)!=-1)
    ( 
      &match=1
    )
  )
  else if (&wild_head==1)
  (
    if (STRING.MID("gcc_vfe_qdss_tsctr_div8_clk", &clk_itr_length-&clk_input_length+1, &clk_input_length-1)==STRING.CUT("&clk", 1))
    ( 
      &match=1
    )
  )
  else if (&wild_tail==1)
  (
    if (STRING.MID("gcc_vfe_qdss_tsctr_div8_clk", 0, &clk_input_length-1)==STRING.CUT("&clk", -1))
    ( 
      &match=1
    )
  )	  
  else if ("gcc_vfe_qdss_tsctr_div8_clk"=="&clk")
  (
    &match=1
  )
  
  if (&match==1)
  (
    &clk_test=&CLK_TEST_GCC_VFE_QDSS_TSCTR_DIV8_CLK
    &clk_reg=0
    &clk_reg_name="No CBCR"
    &clk_name="gcc_vfe_qdss_tsctr_div8_clk"
    &clk_reg_cbcr_type="cgc"

    gosub Print_Clk_Info_Line
  )
  
  &match=0
  &wild_head=0
  &wild_tail=0
  &clk_input_length=STRING.LENGTH("&clk")
  &clk_itr_length=STRING.LENGTH("gcc_crypto_ahb_clk")

  if (STRING.SCAN("&clk", "*", 0)==0)
  (
    &wild_head=1
  )
  if (STRING.SCAN("&clk", "*", 1)==(STRING.LENGTH("&clk")-1))
  (
    &wild_tail=1
  )

  if ((&wild_head==1)&&(&wild_tail==1))
  (
    if (STRING.SCAN("gcc_crypto_ahb_clk", STRING.MID("&clk", 1, &clk_input_length-2), 0)!=-1)
    ( 
      &match=1
    )
  )
  else if (&wild_head==1)
  (
    if (STRING.MID("gcc_crypto_ahb_clk", &clk_itr_length-&clk_input_length+1, &clk_input_length-1)==STRING.CUT("&clk", 1))
    ( 
      &match=1
    )
  )
  else if (&wild_tail==1)
  (
    if (STRING.MID("gcc_crypto_ahb_clk", 0, &clk_input_length-1)==STRING.CUT("&clk", -1))
    ( 
      &match=1
    )
  )	  
  else if ("gcc_crypto_ahb_clk"=="&clk")
  (
    &match=1
  )
  
  if (&match==1)
  (
    &clk_test=&CLK_TEST_GCC_CRYPTO_AHB_CLK
    &clk_reg=&HWIO_GCC_CRYPTO_AHB_CBCR_ADDR
    &clk_reg_name="GCC_CRYPTO_AHB_CBCR"
    &clk_name="gcc_crypto_ahb_clk"
    &clk_reg_cbcr_type="sm_cbc"

    gosub Print_Clk_Info_Line
  )
  
  &match=0
  &wild_head=0
  &wild_tail=0
  &clk_input_length=STRING.LENGTH("&clk")
  &clk_itr_length=STRING.LENGTH("gcc_crypto_axi_clk")

  if (STRING.SCAN("&clk", "*", 0)==0)
  (
    &wild_head=1
  )
  if (STRING.SCAN("&clk", "*", 1)==(STRING.LENGTH("&clk")-1))
  (
    &wild_tail=1
  )

  if ((&wild_head==1)&&(&wild_tail==1))
  (
    if (STRING.SCAN("gcc_crypto_axi_clk", STRING.MID("&clk", 1, &clk_input_length-2), 0)!=-1)
    ( 
      &match=1
    )
  )
  else if (&wild_head==1)
  (
    if (STRING.MID("gcc_crypto_axi_clk", &clk_itr_length-&clk_input_length+1, &clk_input_length-1)==STRING.CUT("&clk", 1))
    ( 
      &match=1
    )
  )
  else if (&wild_tail==1)
  (
    if (STRING.MID("gcc_crypto_axi_clk", 0, &clk_input_length-1)==STRING.CUT("&clk", -1))
    ( 
      &match=1
    )
  )	  
  else if ("gcc_crypto_axi_clk"=="&clk")
  (
    &match=1
  )
  
  if (&match==1)
  (
    &clk_test=&CLK_TEST_GCC_CRYPTO_AXI_CLK
    &clk_reg=&HWIO_GCC_CRYPTO_AXI_CBCR_ADDR
    &clk_reg_name="GCC_CRYPTO_AXI_CBCR"
    &clk_name="gcc_crypto_axi_clk"
    &clk_reg_cbcr_type="sm_cbc"

    gosub Print_Clk_Info_Line
  )
  
  &match=0
  &wild_head=0
  &wild_tail=0
  &clk_input_length=STRING.LENGTH("&clk")
  &clk_itr_length=STRING.LENGTH("gcc_crypto_clk")

  if (STRING.SCAN("&clk", "*", 0)==0)
  (
    &wild_head=1
  )
  if (STRING.SCAN("&clk", "*", 1)==(STRING.LENGTH("&clk")-1))
  (
    &wild_tail=1
  )

  if ((&wild_head==1)&&(&wild_tail==1))
  (
    if (STRING.SCAN("gcc_crypto_clk", STRING.MID("&clk", 1, &clk_input_length-2), 0)!=-1)
    ( 
      &match=1
    )
  )
  else if (&wild_head==1)
  (
    if (STRING.MID("gcc_crypto_clk", &clk_itr_length-&clk_input_length+1, &clk_input_length-1)==STRING.CUT("&clk", 1))
    ( 
      &match=1
    )
  )
  else if (&wild_tail==1)
  (
    if (STRING.MID("gcc_crypto_clk", 0, &clk_input_length-1)==STRING.CUT("&clk", -1))
    ( 
      &match=1
    )
  )	  
  else if ("gcc_crypto_clk"=="&clk")
  (
    &match=1
  )
  
  if (&match==1)
  (
    &clk_test=&CLK_TEST_GCC_CRYPTO_CLK
    &clk_reg=&HWIO_GCC_CRYPTO_CBCR_ADDR
    &clk_reg_name="GCC_CRYPTO_CBCR"
    &clk_name="gcc_crypto_clk"
    &clk_reg_cbcr_type="sm_pscbc"

    gosub Print_Clk_Info_Line
  )
  
  &match=0
  &wild_head=0
  &wild_tail=0
  &clk_input_length=STRING.LENGTH("&clk")
  &clk_itr_length=STRING.LENGTH("gcc_dcd_xo_clk")

  if (STRING.SCAN("&clk", "*", 0)==0)
  (
    &wild_head=1
  )
  if (STRING.SCAN("&clk", "*", 1)==(STRING.LENGTH("&clk")-1))
  (
    &wild_tail=1
  )

  if ((&wild_head==1)&&(&wild_tail==1))
  (
    if (STRING.SCAN("gcc_dcd_xo_clk", STRING.MID("&clk", 1, &clk_input_length-2), 0)!=-1)
    ( 
      &match=1
    )
  )
  else if (&wild_head==1)
  (
    if (STRING.MID("gcc_dcd_xo_clk", &clk_itr_length-&clk_input_length+1, &clk_input_length-1)==STRING.CUT("&clk", 1))
    ( 
      &match=1
    )
  )
  else if (&wild_tail==1)
  (
    if (STRING.MID("gcc_dcd_xo_clk", 0, &clk_input_length-1)==STRING.CUT("&clk", -1))
    ( 
      &match=1
    )
  )	  
  else if ("gcc_dcd_xo_clk"=="&clk")
  (
    &match=1
  )
  
  if (&match==1)
  (
    &clk_test=&CLK_TEST_GCC_DCD_XO_CLK
    &clk_reg=&HWIO_GCC_DCD_XO_CBCR_ADDR
    &clk_reg_name="GCC_DCD_XO_CBCR"
    &clk_name="gcc_dcd_xo_clk"
    &clk_reg_cbcr_type="sm_cbc"

    gosub Print_Clk_Info_Line
  )
  
  &match=0
  &wild_head=0
  &wild_tail=0
  &clk_input_length=STRING.LENGTH("&clk")
  &clk_itr_length=STRING.LENGTH("gcc_ddr_dim_cfg_clk")

  if (STRING.SCAN("&clk", "*", 0)==0)
  (
    &wild_head=1
  )
  if (STRING.SCAN("&clk", "*", 1)==(STRING.LENGTH("&clk")-1))
  (
    &wild_tail=1
  )

  if ((&wild_head==1)&&(&wild_tail==1))
  (
    if (STRING.SCAN("gcc_ddr_dim_cfg_clk", STRING.MID("&clk", 1, &clk_input_length-2), 0)!=-1)
    ( 
      &match=1
    )
  )
  else if (&wild_head==1)
  (
    if (STRING.MID("gcc_ddr_dim_cfg_clk", &clk_itr_length-&clk_input_length+1, &clk_input_length-1)==STRING.CUT("&clk", 1))
    ( 
      &match=1
    )
  )
  else if (&wild_tail==1)
  (
    if (STRING.MID("gcc_ddr_dim_cfg_clk", 0, &clk_input_length-1)==STRING.CUT("&clk", -1))
    ( 
      &match=1
    )
  )	  
  else if ("gcc_ddr_dim_cfg_clk"=="&clk")
  (
    &match=1
  )
  
  if (&match==1)
  (
    &clk_test=&CLK_TEST_GCC_DDR_DIM_CFG_CLK
    &clk_reg=&HWIO_GCC_DDR_DIM_CFG_CBCR_ADDR
    &clk_reg_name="GCC_DDR_DIM_CFG_CBCR"
    &clk_name="gcc_ddr_dim_cfg_clk"
    &clk_reg_cbcr_type="sm_cbc"

    gosub Print_Clk_Info_Line
  )
  
  &match=0
  &wild_head=0
  &wild_tail=0
  &clk_input_length=STRING.LENGTH("&clk")
  &clk_itr_length=STRING.LENGTH("gcc_ddr_dim_sleep_clk")

  if (STRING.SCAN("&clk", "*", 0)==0)
  (
    &wild_head=1
  )
  if (STRING.SCAN("&clk", "*", 1)==(STRING.LENGTH("&clk")-1))
  (
    &wild_tail=1
  )

  if ((&wild_head==1)&&(&wild_tail==1))
  (
    if (STRING.SCAN("gcc_ddr_dim_sleep_clk", STRING.MID("&clk", 1, &clk_input_length-2), 0)!=-1)
    ( 
      &match=1
    )
  )
  else if (&wild_head==1)
  (
    if (STRING.MID("gcc_ddr_dim_sleep_clk", &clk_itr_length-&clk_input_length+1, &clk_input_length-1)==STRING.CUT("&clk", 1))
    ( 
      &match=1
    )
  )
  else if (&wild_tail==1)
  (
    if (STRING.MID("gcc_ddr_dim_sleep_clk", 0, &clk_input_length-1)==STRING.CUT("&clk", -1))
    ( 
      &match=1
    )
  )	  
  else if ("gcc_ddr_dim_sleep_clk"=="&clk")
  (
    &match=1
  )
  
  if (&match==1)
  (
    &clk_test=&CLK_TEST_GCC_DDR_DIM_SLEEP_CLK
    &clk_reg=&HWIO_GCC_DDR_DIM_SLEEP_CBCR_ADDR
    &clk_reg_name="GCC_DDR_DIM_SLEEP_CBCR"
    &clk_name="gcc_ddr_dim_sleep_clk"
    &clk_reg_cbcr_type="sm_cbc"

    gosub Print_Clk_Info_Line
  )
  
  &match=0
  &wild_head=0
  &wild_tail=0
  &clk_input_length=STRING.LENGTH("&clk")
  &clk_itr_length=STRING.LENGTH("gcc_pcnoc_ddr_cfg_clk")

  if (STRING.SCAN("&clk", "*", 0)==0)
  (
    &wild_head=1
  )
  if (STRING.SCAN("&clk", "*", 1)==(STRING.LENGTH("&clk")-1))
  (
    &wild_tail=1
  )

  if ((&wild_head==1)&&(&wild_tail==1))
  (
    if (STRING.SCAN("gcc_pcnoc_ddr_cfg_clk", STRING.MID("&clk", 1, &clk_input_length-2), 0)!=-1)
    ( 
      &match=1
    )
  )
  else if (&wild_head==1)
  (
    if (STRING.MID("gcc_pcnoc_ddr_cfg_clk", &clk_itr_length-&clk_input_length+1, &clk_input_length-1)==STRING.CUT("&clk", 1))
    ( 
      &match=1
    )
  )
  else if (&wild_tail==1)
  (
    if (STRING.MID("gcc_pcnoc_ddr_cfg_clk", 0, &clk_input_length-1)==STRING.CUT("&clk", -1))
    ( 
      &match=1
    )
  )	  
  else if ("gcc_pcnoc_ddr_cfg_clk"=="&clk")
  (
    &match=1
  )
  
  if (&match==1)
  (
    &clk_test=&CLK_TEST_GCC_PCNOC_DDR_CFG_CLK
    &clk_reg=&HWIO_GCC_PCNOC_DDR_CFG_CBCR_ADDR
    &clk_reg_name="GCC_PCNOC_DDR_CFG_CBCR"
    &clk_name="gcc_pcnoc_ddr_cfg_clk"
    &clk_reg_cbcr_type="sm_cbc"

    gosub Print_Clk_Info_Line
  )
  
  &match=0
  &wild_head=0
  &wild_tail=0
  &clk_input_length=STRING.LENGTH("&clk")
  &clk_itr_length=STRING.LENGTH("gcc_dehr_clk")

  if (STRING.SCAN("&clk", "*", 0)==0)
  (
    &wild_head=1
  )
  if (STRING.SCAN("&clk", "*", 1)==(STRING.LENGTH("&clk")-1))
  (
    &wild_tail=1
  )

  if ((&wild_head==1)&&(&wild_tail==1))
  (
    if (STRING.SCAN("gcc_dehr_clk", STRING.MID("&clk", 1, &clk_input_length-2), 0)!=-1)
    ( 
      &match=1
    )
  )
  else if (&wild_head==1)
  (
    if (STRING.MID("gcc_dehr_clk", &clk_itr_length-&clk_input_length+1, &clk_input_length-1)==STRING.CUT("&clk", 1))
    ( 
      &match=1
    )
  )
  else if (&wild_tail==1)
  (
    if (STRING.MID("gcc_dehr_clk", 0, &clk_input_length-1)==STRING.CUT("&clk", -1))
    ( 
      &match=1
    )
  )	  
  else if ("gcc_dehr_clk"=="&clk")
  (
    &match=1
  )
  
  if (&match==1)
  (
    &clk_test=&CLK_TEST_GCC_DEHR_CLK
    &clk_reg=&HWIO_GCC_DEHR_CBCR_ADDR
    &clk_reg_name="GCC_DEHR_CBCR"
    &clk_name="gcc_dehr_clk"
    &clk_reg_cbcr_type="sm_pscbc"

    gosub Print_Clk_Info_Line
  )
  
  &match=0
  &wild_head=0
  &wild_tail=0
  &clk_input_length=STRING.LENGTH("&clk")
  &clk_itr_length=STRING.LENGTH("gcc_ahb_clk")

  if (STRING.SCAN("&clk", "*", 0)==0)
  (
    &wild_head=1
  )
  if (STRING.SCAN("&clk", "*", 1)==(STRING.LENGTH("&clk")-1))
  (
    &wild_tail=1
  )

  if ((&wild_head==1)&&(&wild_tail==1))
  (
    if (STRING.SCAN("gcc_ahb_clk", STRING.MID("&clk", 1, &clk_input_length-2), 0)!=-1)
    ( 
      &match=1
    )
  )
  else if (&wild_head==1)
  (
    if (STRING.MID("gcc_ahb_clk", &clk_itr_length-&clk_input_length+1, &clk_input_length-1)==STRING.CUT("&clk", 1))
    ( 
      &match=1
    )
  )
  else if (&wild_tail==1)
  (
    if (STRING.MID("gcc_ahb_clk", 0, &clk_input_length-1)==STRING.CUT("&clk", -1))
    ( 
      &match=1
    )
  )	  
  else if ("gcc_ahb_clk"=="&clk")
  (
    &match=1
  )
  
  if (&match==1)
  (
    &clk_test=&CLK_TEST_GCC_AHB_CLK
    &clk_reg=&HWIO_GCC_AHB_CBCR_ADDR
    &clk_reg_name="GCC_AHB_CBCR"
    &clk_name="gcc_ahb_clk"
    &clk_reg_cbcr_type="sm_cbc"

    gosub Print_Clk_Info_Line
  )
  
  &match=0
  &wild_head=0
  &wild_tail=0
  &clk_input_length=STRING.LENGTH("&clk")
  &clk_itr_length=STRING.LENGTH("gcc_im_sleep_clk")

  if (STRING.SCAN("&clk", "*", 0)==0)
  (
    &wild_head=1
  )
  if (STRING.SCAN("&clk", "*", 1)==(STRING.LENGTH("&clk")-1))
  (
    &wild_tail=1
  )

  if ((&wild_head==1)&&(&wild_tail==1))
  (
    if (STRING.SCAN("gcc_im_sleep_clk", STRING.MID("&clk", 1, &clk_input_length-2), 0)!=-1)
    ( 
      &match=1
    )
  )
  else if (&wild_head==1)
  (
    if (STRING.MID("gcc_im_sleep_clk", &clk_itr_length-&clk_input_length+1, &clk_input_length-1)==STRING.CUT("&clk", 1))
    ( 
      &match=1
    )
  )
  else if (&wild_tail==1)
  (
    if (STRING.MID("gcc_im_sleep_clk", 0, &clk_input_length-1)==STRING.CUT("&clk", -1))
    ( 
      &match=1
    )
  )	  
  else if ("gcc_im_sleep_clk"=="&clk")
  (
    &match=1
  )
  
  if (&match==1)
  (
    &clk_test=&CLK_TEST_GCC_IM_SLEEP_CLK
    &clk_reg=&HWIO_GCC_IM_SLEEP_CBCR_ADDR
    &clk_reg_name="GCC_IM_SLEEP_CBCR"
    &clk_name="gcc_im_sleep_clk"
    &clk_reg_cbcr_type="sm_cbc"

    gosub Print_Clk_Info_Line
  )
  
  &match=0
  &wild_head=0
  &wild_tail=0
  &clk_input_length=STRING.LENGTH("&clk")
  &clk_itr_length=STRING.LENGTH("gcc_xo_clk")

  if (STRING.SCAN("&clk", "*", 0)==0)
  (
    &wild_head=1
  )
  if (STRING.SCAN("&clk", "*", 1)==(STRING.LENGTH("&clk")-1))
  (
    &wild_tail=1
  )

  if ((&wild_head==1)&&(&wild_tail==1))
  (
    if (STRING.SCAN("gcc_xo_clk", STRING.MID("&clk", 1, &clk_input_length-2), 0)!=-1)
    ( 
      &match=1
    )
  )
  else if (&wild_head==1)
  (
    if (STRING.MID("gcc_xo_clk", &clk_itr_length-&clk_input_length+1, &clk_input_length-1)==STRING.CUT("&clk", 1))
    ( 
      &match=1
    )
  )
  else if (&wild_tail==1)
  (
    if (STRING.MID("gcc_xo_clk", 0, &clk_input_length-1)==STRING.CUT("&clk", -1))
    ( 
      &match=1
    )
  )	  
  else if ("gcc_xo_clk"=="&clk")
  (
    &match=1
  )
  
  if (&match==1)
  (
    &clk_test=&CLK_TEST_GCC_XO_CLK
    &clk_reg=&HWIO_GCC_XO_CBCR_ADDR
    &clk_reg_name="GCC_XO_CBCR"
    &clk_name="gcc_xo_clk"
    &clk_reg_cbcr_type="sm_cbc"

    gosub Print_Clk_Info_Line
  )
  
  &match=0
  &wild_head=0
  &wild_tail=0
  &clk_input_length=STRING.LENGTH("&clk")
  &clk_itr_length=STRING.LENGTH("gcc_xo_div4_clk")

  if (STRING.SCAN("&clk", "*", 0)==0)
  (
    &wild_head=1
  )
  if (STRING.SCAN("&clk", "*", 1)==(STRING.LENGTH("&clk")-1))
  (
    &wild_tail=1
  )

  if ((&wild_head==1)&&(&wild_tail==1))
  (
    if (STRING.SCAN("gcc_xo_div4_clk", STRING.MID("&clk", 1, &clk_input_length-2), 0)!=-1)
    ( 
      &match=1
    )
  )
  else if (&wild_head==1)
  (
    if (STRING.MID("gcc_xo_div4_clk", &clk_itr_length-&clk_input_length+1, &clk_input_length-1)==STRING.CUT("&clk", 1))
    ( 
      &match=1
    )
  )
  else if (&wild_tail==1)
  (
    if (STRING.MID("gcc_xo_div4_clk", 0, &clk_input_length-1)==STRING.CUT("&clk", -1))
    ( 
      &match=1
    )
  )	  
  else if ("gcc_xo_div4_clk"=="&clk")
  (
    &match=1
  )
  
  if (&match==1)
  (
    &clk_test=&CLK_TEST_GCC_XO_DIV4_CLK
    &clk_reg=&HWIO_GCC_XO_DIV4_CBCR_ADDR
    &clk_reg_name="GCC_XO_DIV4_CBCR"
    &clk_name="gcc_xo_div4_clk"
    &clk_reg_cbcr_type="sm_cbc"

    gosub Print_Clk_Info_Line
  )
  
  &match=0
  &wild_head=0
  &wild_tail=0
  &clk_input_length=STRING.LENGTH("&clk")
  &clk_itr_length=STRING.LENGTH("gcc_spdm_ahb_clk")

  if (STRING.SCAN("&clk", "*", 0)==0)
  (
    &wild_head=1
  )
  if (STRING.SCAN("&clk", "*", 1)==(STRING.LENGTH("&clk")-1))
  (
    &wild_tail=1
  )

  if ((&wild_head==1)&&(&wild_tail==1))
  (
    if (STRING.SCAN("gcc_spdm_ahb_clk", STRING.MID("&clk", 1, &clk_input_length-2), 0)!=-1)
    ( 
      &match=1
    )
  )
  else if (&wild_head==1)
  (
    if (STRING.MID("gcc_spdm_ahb_clk", &clk_itr_length-&clk_input_length+1, &clk_input_length-1)==STRING.CUT("&clk", 1))
    ( 
      &match=1
    )
  )
  else if (&wild_tail==1)
  (
    if (STRING.MID("gcc_spdm_ahb_clk", 0, &clk_input_length-1)==STRING.CUT("&clk", -1))
    ( 
      &match=1
    )
  )	  
  else if ("gcc_spdm_ahb_clk"=="&clk")
  (
    &match=1
  )
  
  if (&match==1)
  (
    &clk_test=&CLK_TEST_GCC_SPDM_AHB_CLK
    &clk_reg=&HWIO_GCC_SPDM_AHB_CBCR_ADDR
    &clk_reg_name="GCC_SPDM_AHB_CBCR"
    &clk_name="gcc_spdm_ahb_clk"
    &clk_reg_cbcr_type="sm_cbc"

    gosub Print_Clk_Info_Line
  )
  
  &match=0
  &wild_head=0
  &wild_tail=0
  &clk_input_length=STRING.LENGTH("&clk")
  &clk_itr_length=STRING.LENGTH("gcc_spdm_csi0_clk")

  if (STRING.SCAN("&clk", "*", 0)==0)
  (
    &wild_head=1
  )
  if (STRING.SCAN("&clk", "*", 1)==(STRING.LENGTH("&clk")-1))
  (
    &wild_tail=1
  )

  if ((&wild_head==1)&&(&wild_tail==1))
  (
    if (STRING.SCAN("gcc_spdm_csi0_clk", STRING.MID("&clk", 1, &clk_input_length-2), 0)!=-1)
    ( 
      &match=1
    )
  )
  else if (&wild_head==1)
  (
    if (STRING.MID("gcc_spdm_csi0_clk", &clk_itr_length-&clk_input_length+1, &clk_input_length-1)==STRING.CUT("&clk", 1))
    ( 
      &match=1
    )
  )
  else if (&wild_tail==1)
  (
    if (STRING.MID("gcc_spdm_csi0_clk", 0, &clk_input_length-1)==STRING.CUT("&clk", -1))
    ( 
      &match=1
    )
  )	  
  else if ("gcc_spdm_csi0_clk"=="&clk")
  (
    &match=1
  )
  
  if (&match==1)
  (
    &clk_test=&CLK_TEST_GCC_SPDM_CSI0_CLK
    &clk_reg=&HWIO_GCC_SPDM_CSI0_CBCR_ADDR
    &clk_reg_name="GCC_SPDM_CSI0_CBCR"
    &clk_name="gcc_spdm_csi0_clk"
    &clk_reg_cbcr_type="sm_cbc"

    gosub Print_Clk_Info_Line
  )
  
  &match=0
  &wild_head=0
  &wild_tail=0
  &clk_input_length=STRING.LENGTH("&clk")
  &clk_itr_length=STRING.LENGTH("gcc_spdm_gfx3d_clk")

  if (STRING.SCAN("&clk", "*", 0)==0)
  (
    &wild_head=1
  )
  if (STRING.SCAN("&clk", "*", 1)==(STRING.LENGTH("&clk")-1))
  (
    &wild_tail=1
  )

  if ((&wild_head==1)&&(&wild_tail==1))
  (
    if (STRING.SCAN("gcc_spdm_gfx3d_clk", STRING.MID("&clk", 1, &clk_input_length-2), 0)!=-1)
    ( 
      &match=1
    )
  )
  else if (&wild_head==1)
  (
    if (STRING.MID("gcc_spdm_gfx3d_clk", &clk_itr_length-&clk_input_length+1, &clk_input_length-1)==STRING.CUT("&clk", 1))
    ( 
      &match=1
    )
  )
  else if (&wild_tail==1)
  (
    if (STRING.MID("gcc_spdm_gfx3d_clk", 0, &clk_input_length-1)==STRING.CUT("&clk", -1))
    ( 
      &match=1
    )
  )	  
  else if ("gcc_spdm_gfx3d_clk"=="&clk")
  (
    &match=1
  )
  
  if (&match==1)
  (
    &clk_test=&CLK_TEST_GCC_SPDM_GFX3D_CLK
    &clk_reg=&HWIO_GCC_SPDM_GFX3D_CBCR_ADDR
    &clk_reg_name="GCC_SPDM_GFX3D_CBCR"
    &clk_name="gcc_spdm_gfx3d_clk"
    &clk_reg_cbcr_type="sm_cbc"

    gosub Print_Clk_Info_Line
  )
  
  &match=0
  &wild_head=0
  &wild_tail=0
  &clk_input_length=STRING.LENGTH("&clk")
  &clk_itr_length=STRING.LENGTH("gcc_spdm_mdp_clk")

  if (STRING.SCAN("&clk", "*", 0)==0)
  (
    &wild_head=1
  )
  if (STRING.SCAN("&clk", "*", 1)==(STRING.LENGTH("&clk")-1))
  (
    &wild_tail=1
  )

  if ((&wild_head==1)&&(&wild_tail==1))
  (
    if (STRING.SCAN("gcc_spdm_mdp_clk", STRING.MID("&clk", 1, &clk_input_length-2), 0)!=-1)
    ( 
      &match=1
    )
  )
  else if (&wild_head==1)
  (
    if (STRING.MID("gcc_spdm_mdp_clk", &clk_itr_length-&clk_input_length+1, &clk_input_length-1)==STRING.CUT("&clk", 1))
    ( 
      &match=1
    )
  )
  else if (&wild_tail==1)
  (
    if (STRING.MID("gcc_spdm_mdp_clk", 0, &clk_input_length-1)==STRING.CUT("&clk", -1))
    ( 
      &match=1
    )
  )	  
  else if ("gcc_spdm_mdp_clk"=="&clk")
  (
    &match=1
  )
  
  if (&match==1)
  (
    &clk_test=&CLK_TEST_GCC_SPDM_MDP_CLK
    &clk_reg=&HWIO_GCC_SPDM_MDP_CBCR_ADDR
    &clk_reg_name="GCC_SPDM_MDP_CBCR"
    &clk_name="gcc_spdm_mdp_clk"
    &clk_reg_cbcr_type="sm_cbc"

    gosub Print_Clk_Info_Line
  )
  
  &match=0
  &wild_head=0
  &wild_tail=0
  &clk_input_length=STRING.LENGTH("&clk")
  &clk_itr_length=STRING.LENGTH("gcc_spdm_pclk0_clk")

  if (STRING.SCAN("&clk", "*", 0)==0)
  (
    &wild_head=1
  )
  if (STRING.SCAN("&clk", "*", 1)==(STRING.LENGTH("&clk")-1))
  (
    &wild_tail=1
  )

  if ((&wild_head==1)&&(&wild_tail==1))
  (
    if (STRING.SCAN("gcc_spdm_pclk0_clk", STRING.MID("&clk", 1, &clk_input_length-2), 0)!=-1)
    ( 
      &match=1
    )
  )
  else if (&wild_head==1)
  (
    if (STRING.MID("gcc_spdm_pclk0_clk", &clk_itr_length-&clk_input_length+1, &clk_input_length-1)==STRING.CUT("&clk", 1))
    ( 
      &match=1
    )
  )
  else if (&wild_tail==1)
  (
    if (STRING.MID("gcc_spdm_pclk0_clk", 0, &clk_input_length-1)==STRING.CUT("&clk", -1))
    ( 
      &match=1
    )
  )	  
  else if ("gcc_spdm_pclk0_clk"=="&clk")
  (
    &match=1
  )
  
  if (&match==1)
  (
    &clk_test=&CLK_TEST_GCC_SPDM_PCLK0_CLK
    &clk_reg=&HWIO_GCC_SPDM_PCLK0_CBCR_ADDR
    &clk_reg_name="GCC_SPDM_PCLK0_CBCR"
    &clk_name="gcc_spdm_pclk0_clk"
    &clk_reg_cbcr_type="sm_cbc"

    gosub Print_Clk_Info_Line
  )
  
  &match=0
  &wild_head=0
  &wild_tail=0
  &clk_input_length=STRING.LENGTH("&clk")
  &clk_itr_length=STRING.LENGTH("gcc_spdm_vcodec0_clk")

  if (STRING.SCAN("&clk", "*", 0)==0)
  (
    &wild_head=1
  )
  if (STRING.SCAN("&clk", "*", 1)==(STRING.LENGTH("&clk")-1))
  (
    &wild_tail=1
  )

  if ((&wild_head==1)&&(&wild_tail==1))
  (
    if (STRING.SCAN("gcc_spdm_vcodec0_clk", STRING.MID("&clk", 1, &clk_input_length-2), 0)!=-1)
    ( 
      &match=1
    )
  )
  else if (&wild_head==1)
  (
    if (STRING.MID("gcc_spdm_vcodec0_clk", &clk_itr_length-&clk_input_length+1, &clk_input_length-1)==STRING.CUT("&clk", 1))
    ( 
      &match=1
    )
  )
  else if (&wild_tail==1)
  (
    if (STRING.MID("gcc_spdm_vcodec0_clk", 0, &clk_input_length-1)==STRING.CUT("&clk", -1))
    ( 
      &match=1
    )
  )	  
  else if ("gcc_spdm_vcodec0_clk"=="&clk")
  (
    &match=1
  )
  
  if (&match==1)
  (
    &clk_test=&CLK_TEST_GCC_SPDM_VCODEC0_CLK
    &clk_reg=&HWIO_GCC_SPDM_VCODEC0_CBCR_ADDR
    &clk_reg_name="GCC_SPDM_VCODEC0_CBCR"
    &clk_name="gcc_spdm_vcodec0_clk"
    &clk_reg_cbcr_type="sm_cbc"

    gosub Print_Clk_Info_Line
  )
  
  &match=0
  &wild_head=0
  &wild_tail=0
  &clk_input_length=STRING.LENGTH("&clk")
  &clk_itr_length=STRING.LENGTH("gcc_spdm_vfe0_clk")

  if (STRING.SCAN("&clk", "*", 0)==0)
  (
    &wild_head=1
  )
  if (STRING.SCAN("&clk", "*", 1)==(STRING.LENGTH("&clk")-1))
  (
    &wild_tail=1
  )

  if ((&wild_head==1)&&(&wild_tail==1))
  (
    if (STRING.SCAN("gcc_spdm_vfe0_clk", STRING.MID("&clk", 1, &clk_input_length-2), 0)!=-1)
    ( 
      &match=1
    )
  )
  else if (&wild_head==1)
  (
    if (STRING.MID("gcc_spdm_vfe0_clk", &clk_itr_length-&clk_input_length+1, &clk_input_length-1)==STRING.CUT("&clk", 1))
    ( 
      &match=1
    )
  )
  else if (&wild_tail==1)
  (
    if (STRING.MID("gcc_spdm_vfe0_clk", 0, &clk_input_length-1)==STRING.CUT("&clk", -1))
    ( 
      &match=1
    )
  )	  
  else if ("gcc_spdm_vfe0_clk"=="&clk")
  (
    &match=1
  )
  
  if (&match==1)
  (
    &clk_test=&CLK_TEST_GCC_SPDM_VFE0_CLK
    &clk_reg=&HWIO_GCC_SPDM_VFE0_CBCR_ADDR
    &clk_reg_name="GCC_SPDM_VFE0_CBCR"
    &clk_name="gcc_spdm_vfe0_clk"
    &clk_reg_cbcr_type="sm_cbc"

    gosub Print_Clk_Info_Line
  )
  
  &match=0
  &wild_head=0
  &wild_tail=0
  &clk_input_length=STRING.LENGTH("&clk")
  &clk_itr_length=STRING.LENGTH("gcc_gp1_clk")

  if (STRING.SCAN("&clk", "*", 0)==0)
  (
    &wild_head=1
  )
  if (STRING.SCAN("&clk", "*", 1)==(STRING.LENGTH("&clk")-1))
  (
    &wild_tail=1
  )

  if ((&wild_head==1)&&(&wild_tail==1))
  (
    if (STRING.SCAN("gcc_gp1_clk", STRING.MID("&clk", 1, &clk_input_length-2), 0)!=-1)
    ( 
      &match=1
    )
  )
  else if (&wild_head==1)
  (
    if (STRING.MID("gcc_gp1_clk", &clk_itr_length-&clk_input_length+1, &clk_input_length-1)==STRING.CUT("&clk", 1))
    ( 
      &match=1
    )
  )
  else if (&wild_tail==1)
  (
    if (STRING.MID("gcc_gp1_clk", 0, &clk_input_length-1)==STRING.CUT("&clk", -1))
    ( 
      &match=1
    )
  )	  
  else if ("gcc_gp1_clk"=="&clk")
  (
    &match=1
  )
  
  if (&match==1)
  (
    &clk_test=&CLK_TEST_GCC_GP1_CLK
    &clk_reg=&HWIO_GCC_GP1_CBCR_ADDR
    &clk_reg_name="GCC_GP1_CBCR"
    &clk_name="gcc_gp1_clk"
    &clk_reg_cbcr_type="sm_cbc"

    gosub Print_Clk_Info_Line
  )
  
  &match=0
  &wild_head=0
  &wild_tail=0
  &clk_input_length=STRING.LENGTH("&clk")
  &clk_itr_length=STRING.LENGTH("gcc_gp2_clk")

  if (STRING.SCAN("&clk", "*", 0)==0)
  (
    &wild_head=1
  )
  if (STRING.SCAN("&clk", "*", 1)==(STRING.LENGTH("&clk")-1))
  (
    &wild_tail=1
  )

  if ((&wild_head==1)&&(&wild_tail==1))
  (
    if (STRING.SCAN("gcc_gp2_clk", STRING.MID("&clk", 1, &clk_input_length-2), 0)!=-1)
    ( 
      &match=1
    )
  )
  else if (&wild_head==1)
  (
    if (STRING.MID("gcc_gp2_clk", &clk_itr_length-&clk_input_length+1, &clk_input_length-1)==STRING.CUT("&clk", 1))
    ( 
      &match=1
    )
  )
  else if (&wild_tail==1)
  (
    if (STRING.MID("gcc_gp2_clk", 0, &clk_input_length-1)==STRING.CUT("&clk", -1))
    ( 
      &match=1
    )
  )	  
  else if ("gcc_gp2_clk"=="&clk")
  (
    &match=1
  )
  
  if (&match==1)
  (
    &clk_test=&CLK_TEST_GCC_GP2_CLK
    &clk_reg=&HWIO_GCC_GP2_CBCR_ADDR
    &clk_reg_name="GCC_GP2_CBCR"
    &clk_name="gcc_gp2_clk"
    &clk_reg_cbcr_type="sm_cbc"

    gosub Print_Clk_Info_Line
  )
  
  &match=0
  &wild_head=0
  &wild_tail=0
  &clk_input_length=STRING.LENGTH("&clk")
  &clk_itr_length=STRING.LENGTH("gcc_gp3_clk")

  if (STRING.SCAN("&clk", "*", 0)==0)
  (
    &wild_head=1
  )
  if (STRING.SCAN("&clk", "*", 1)==(STRING.LENGTH("&clk")-1))
  (
    &wild_tail=1
  )

  if ((&wild_head==1)&&(&wild_tail==1))
  (
    if (STRING.SCAN("gcc_gp3_clk", STRING.MID("&clk", 1, &clk_input_length-2), 0)!=-1)
    ( 
      &match=1
    )
  )
  else if (&wild_head==1)
  (
    if (STRING.MID("gcc_gp3_clk", &clk_itr_length-&clk_input_length+1, &clk_input_length-1)==STRING.CUT("&clk", 1))
    ( 
      &match=1
    )
  )
  else if (&wild_tail==1)
  (
    if (STRING.MID("gcc_gp3_clk", 0, &clk_input_length-1)==STRING.CUT("&clk", -1))
    ( 
      &match=1
    )
  )	  
  else if ("gcc_gp3_clk"=="&clk")
  (
    &match=1
  )
  
  if (&match==1)
  (
    &clk_test=&CLK_TEST_GCC_GP3_CLK
    &clk_reg=&HWIO_GCC_GP3_CBCR_ADDR
    &clk_reg_name="GCC_GP3_CBCR"
    &clk_name="gcc_gp3_clk"
    &clk_reg_cbcr_type="sm_cbc"

    gosub Print_Clk_Info_Line
  )
  
  &match=0
  &wild_head=0
  &wild_tail=0
  &clk_input_length=STRING.LENGTH("&clk")
  &clk_itr_length=STRING.LENGTH("gcc_imem_axi_clk")

  if (STRING.SCAN("&clk", "*", 0)==0)
  (
    &wild_head=1
  )
  if (STRING.SCAN("&clk", "*", 1)==(STRING.LENGTH("&clk")-1))
  (
    &wild_tail=1
  )

  if ((&wild_head==1)&&(&wild_tail==1))
  (
    if (STRING.SCAN("gcc_imem_axi_clk", STRING.MID("&clk", 1, &clk_input_length-2), 0)!=-1)
    ( 
      &match=1
    )
  )
  else if (&wild_head==1)
  (
    if (STRING.MID("gcc_imem_axi_clk", &clk_itr_length-&clk_input_length+1, &clk_input_length-1)==STRING.CUT("&clk", 1))
    ( 
      &match=1
    )
  )
  else if (&wild_tail==1)
  (
    if (STRING.MID("gcc_imem_axi_clk", 0, &clk_input_length-1)==STRING.CUT("&clk", -1))
    ( 
      &match=1
    )
  )	  
  else if ("gcc_imem_axi_clk"=="&clk")
  (
    &match=1
  )
  
  if (&match==1)
  (
    &clk_test=&CLK_TEST_GCC_IMEM_AXI_CLK
    &clk_reg=&HWIO_GCC_IMEM_AXI_CBCR_ADDR
    &clk_reg_name="GCC_IMEM_AXI_CBCR"
    &clk_name="gcc_imem_axi_clk"
    &clk_reg_cbcr_type="sm_pscbc"

    gosub Print_Clk_Info_Line
  )
  
  &match=0
  &wild_head=0
  &wild_tail=0
  &clk_input_length=STRING.LENGTH("&clk")
  &clk_itr_length=STRING.LENGTH("gcc_imem_cfg_ahb_clk")

  if (STRING.SCAN("&clk", "*", 0)==0)
  (
    &wild_head=1
  )
  if (STRING.SCAN("&clk", "*", 1)==(STRING.LENGTH("&clk")-1))
  (
    &wild_tail=1
  )

  if ((&wild_head==1)&&(&wild_tail==1))
  (
    if (STRING.SCAN("gcc_imem_cfg_ahb_clk", STRING.MID("&clk", 1, &clk_input_length-2), 0)!=-1)
    ( 
      &match=1
    )
  )
  else if (&wild_head==1)
  (
    if (STRING.MID("gcc_imem_cfg_ahb_clk", &clk_itr_length-&clk_input_length+1, &clk_input_length-1)==STRING.CUT("&clk", 1))
    ( 
      &match=1
    )
  )
  else if (&wild_tail==1)
  (
    if (STRING.MID("gcc_imem_cfg_ahb_clk", 0, &clk_input_length-1)==STRING.CUT("&clk", -1))
    ( 
      &match=1
    )
  )	  
  else if ("gcc_imem_cfg_ahb_clk"=="&clk")
  (
    &match=1
  )
  
  if (&match==1)
  (
    &clk_test=&CLK_TEST_GCC_IMEM_CFG_AHB_CLK
    &clk_reg=&HWIO_GCC_IMEM_CFG_AHB_CBCR_ADDR
    &clk_reg_name="GCC_IMEM_CFG_AHB_CBCR"
    &clk_name="gcc_imem_cfg_ahb_clk"
    &clk_reg_cbcr_type="sm_cbc"

    gosub Print_Clk_Info_Line
  )
  
  &match=0
  &wild_head=0
  &wild_tail=0
  &clk_input_length=STRING.LENGTH("&clk")
  &clk_itr_length=STRING.LENGTH("gcc_mdss_ahb_clk")

  if (STRING.SCAN("&clk", "*", 0)==0)
  (
    &wild_head=1
  )
  if (STRING.SCAN("&clk", "*", 1)==(STRING.LENGTH("&clk")-1))
  (
    &wild_tail=1
  )

  if ((&wild_head==1)&&(&wild_tail==1))
  (
    if (STRING.SCAN("gcc_mdss_ahb_clk", STRING.MID("&clk", 1, &clk_input_length-2), 0)!=-1)
    ( 
      &match=1
    )
  )
  else if (&wild_head==1)
  (
    if (STRING.MID("gcc_mdss_ahb_clk", &clk_itr_length-&clk_input_length+1, &clk_input_length-1)==STRING.CUT("&clk", 1))
    ( 
      &match=1
    )
  )
  else if (&wild_tail==1)
  (
    if (STRING.MID("gcc_mdss_ahb_clk", 0, &clk_input_length-1)==STRING.CUT("&clk", -1))
    ( 
      &match=1
    )
  )	  
  else if ("gcc_mdss_ahb_clk"=="&clk")
  (
    &match=1
  )
  
  if (&match==1)
  (
    &clk_test=&CLK_TEST_GCC_MDSS_AHB_CLK
    &clk_reg=&HWIO_GCC_MDSS_AHB_CBCR_ADDR
    &clk_reg_name="GCC_MDSS_AHB_CBCR"
    &clk_name="gcc_mdss_ahb_clk"
    &clk_reg_cbcr_type="sm_cbc"

    gosub Print_Clk_Info_Line
  )
  
  &match=0
  &wild_head=0
  &wild_tail=0
  &clk_input_length=STRING.LENGTH("&clk")
  &clk_itr_length=STRING.LENGTH("gcc_mdss_axi_clk")

  if (STRING.SCAN("&clk", "*", 0)==0)
  (
    &wild_head=1
  )
  if (STRING.SCAN("&clk", "*", 1)==(STRING.LENGTH("&clk")-1))
  (
    &wild_tail=1
  )

  if ((&wild_head==1)&&(&wild_tail==1))
  (
    if (STRING.SCAN("gcc_mdss_axi_clk", STRING.MID("&clk", 1, &clk_input_length-2), 0)!=-1)
    ( 
      &match=1
    )
  )
  else if (&wild_head==1)
  (
    if (STRING.MID("gcc_mdss_axi_clk", &clk_itr_length-&clk_input_length+1, &clk_input_length-1)==STRING.CUT("&clk", 1))
    ( 
      &match=1
    )
  )
  else if (&wild_tail==1)
  (
    if (STRING.MID("gcc_mdss_axi_clk", 0, &clk_input_length-1)==STRING.CUT("&clk", -1))
    ( 
      &match=1
    )
  )	  
  else if ("gcc_mdss_axi_clk"=="&clk")
  (
    &match=1
  )
  
  if (&match==1)
  (
    &clk_test=&CLK_TEST_GCC_MDSS_AXI_CLK
    &clk_reg=&HWIO_GCC_MDSS_AXI_CBCR_ADDR
    &clk_reg_name="GCC_MDSS_AXI_CBCR"
    &clk_name="gcc_mdss_axi_clk"
    &clk_reg_cbcr_type="sm_pscbc"

    gosub Print_Clk_Info_Line
  )
  
  &match=0
  &wild_head=0
  &wild_tail=0
  &clk_input_length=STRING.LENGTH("&clk")
  &clk_itr_length=STRING.LENGTH("gcc_mdss_byte0_clk")

  if (STRING.SCAN("&clk", "*", 0)==0)
  (
    &wild_head=1
  )
  if (STRING.SCAN("&clk", "*", 1)==(STRING.LENGTH("&clk")-1))
  (
    &wild_tail=1
  )

  if ((&wild_head==1)&&(&wild_tail==1))
  (
    if (STRING.SCAN("gcc_mdss_byte0_clk", STRING.MID("&clk", 1, &clk_input_length-2), 0)!=-1)
    ( 
      &match=1
    )
  )
  else if (&wild_head==1)
  (
    if (STRING.MID("gcc_mdss_byte0_clk", &clk_itr_length-&clk_input_length+1, &clk_input_length-1)==STRING.CUT("&clk", 1))
    ( 
      &match=1
    )
  )
  else if (&wild_tail==1)
  (
    if (STRING.MID("gcc_mdss_byte0_clk", 0, &clk_input_length-1)==STRING.CUT("&clk", -1))
    ( 
      &match=1
    )
  )	  
  else if ("gcc_mdss_byte0_clk"=="&clk")
  (
    &match=1
  )
  
  if (&match==1)
  (
    &clk_test=&CLK_TEST_GCC_MDSS_BYTE0_CLK
    &clk_reg=&HWIO_GCC_MDSS_BYTE0_CBCR_ADDR
    &clk_reg_name="GCC_MDSS_BYTE0_CBCR"
    &clk_name="gcc_mdss_byte0_clk"
    &clk_reg_cbcr_type="sm_cbc"

    gosub Print_Clk_Info_Line
  )
  
  &match=0
  &wild_head=0
  &wild_tail=0
  &clk_input_length=STRING.LENGTH("&clk")
  &clk_itr_length=STRING.LENGTH("gcc_mdss_esc0_clk")

  if (STRING.SCAN("&clk", "*", 0)==0)
  (
    &wild_head=1
  )
  if (STRING.SCAN("&clk", "*", 1)==(STRING.LENGTH("&clk")-1))
  (
    &wild_tail=1
  )

  if ((&wild_head==1)&&(&wild_tail==1))
  (
    if (STRING.SCAN("gcc_mdss_esc0_clk", STRING.MID("&clk", 1, &clk_input_length-2), 0)!=-1)
    ( 
      &match=1
    )
  )
  else if (&wild_head==1)
  (
    if (STRING.MID("gcc_mdss_esc0_clk", &clk_itr_length-&clk_input_length+1, &clk_input_length-1)==STRING.CUT("&clk", 1))
    ( 
      &match=1
    )
  )
  else if (&wild_tail==1)
  (
    if (STRING.MID("gcc_mdss_esc0_clk", 0, &clk_input_length-1)==STRING.CUT("&clk", -1))
    ( 
      &match=1
    )
  )	  
  else if ("gcc_mdss_esc0_clk"=="&clk")
  (
    &match=1
  )
  
  if (&match==1)
  (
    &clk_test=&CLK_TEST_GCC_MDSS_ESC0_CLK
    &clk_reg=&HWIO_GCC_MDSS_ESC0_CBCR_ADDR
    &clk_reg_name="GCC_MDSS_ESC0_CBCR"
    &clk_name="gcc_mdss_esc0_clk"
    &clk_reg_cbcr_type="sm_cbc"

    gosub Print_Clk_Info_Line
  )
  
  &match=0
  &wild_head=0
  &wild_tail=0
  &clk_input_length=STRING.LENGTH("&clk")
  &clk_itr_length=STRING.LENGTH("gcc_mdss_mdp_ahb_clk")

  if (STRING.SCAN("&clk", "*", 0)==0)
  (
    &wild_head=1
  )
  if (STRING.SCAN("&clk", "*", 1)==(STRING.LENGTH("&clk")-1))
  (
    &wild_tail=1
  )

  if ((&wild_head==1)&&(&wild_tail==1))
  (
    if (STRING.SCAN("gcc_mdss_mdp_ahb_clk", STRING.MID("&clk", 1, &clk_input_length-2), 0)!=-1)
    ( 
      &match=1
    )
  )
  else if (&wild_head==1)
  (
    if (STRING.MID("gcc_mdss_mdp_ahb_clk", &clk_itr_length-&clk_input_length+1, &clk_input_length-1)==STRING.CUT("&clk", 1))
    ( 
      &match=1
    )
  )
  else if (&wild_tail==1)
  (
    if (STRING.MID("gcc_mdss_mdp_ahb_clk", 0, &clk_input_length-1)==STRING.CUT("&clk", -1))
    ( 
      &match=1
    )
  )	  
  else if ("gcc_mdss_mdp_ahb_clk"=="&clk")
  (
    &match=1
  )
  
  if (&match==1)
  (
    &clk_test=&CLK_TEST_GCC_MDSS_MDP_AHB_CLK
    &clk_reg=0
    &clk_reg_name="No CBCR"
    &clk_name="gcc_mdss_mdp_ahb_clk"
    &clk_reg_cbcr_type="gfmux"

    gosub Print_Clk_Info_Line
  )
  
  &match=0
  &wild_head=0
  &wild_tail=0
  &clk_input_length=STRING.LENGTH("&clk")
  &clk_itr_length=STRING.LENGTH("gcc_mdss_mdp_clk")

  if (STRING.SCAN("&clk", "*", 0)==0)
  (
    &wild_head=1
  )
  if (STRING.SCAN("&clk", "*", 1)==(STRING.LENGTH("&clk")-1))
  (
    &wild_tail=1
  )

  if ((&wild_head==1)&&(&wild_tail==1))
  (
    if (STRING.SCAN("gcc_mdss_mdp_clk", STRING.MID("&clk", 1, &clk_input_length-2), 0)!=-1)
    ( 
      &match=1
    )
  )
  else if (&wild_head==1)
  (
    if (STRING.MID("gcc_mdss_mdp_clk", &clk_itr_length-&clk_input_length+1, &clk_input_length-1)==STRING.CUT("&clk", 1))
    ( 
      &match=1
    )
  )
  else if (&wild_tail==1)
  (
    if (STRING.MID("gcc_mdss_mdp_clk", 0, &clk_input_length-1)==STRING.CUT("&clk", -1))
    ( 
      &match=1
    )
  )	  
  else if ("gcc_mdss_mdp_clk"=="&clk")
  (
    &match=1
  )
  
  if (&match==1)
  (
    &clk_test=&CLK_TEST_GCC_MDSS_MDP_CLK
    &clk_reg=&HWIO_GCC_MDSS_MDP_CBCR_ADDR
    &clk_reg_name="GCC_MDSS_MDP_CBCR"
    &clk_name="gcc_mdss_mdp_clk"
    &clk_reg_cbcr_type="gfmux"

    gosub Print_Clk_Info_Line
  )
  
  &match=0
  &wild_head=0
  &wild_tail=0
  &clk_input_length=STRING.LENGTH("&clk")
  &clk_itr_length=STRING.LENGTH("gcc_mdss_mdp_dsi_clk")

  if (STRING.SCAN("&clk", "*", 0)==0)
  (
    &wild_head=1
  )
  if (STRING.SCAN("&clk", "*", 1)==(STRING.LENGTH("&clk")-1))
  (
    &wild_tail=1
  )

  if ((&wild_head==1)&&(&wild_tail==1))
  (
    if (STRING.SCAN("gcc_mdss_mdp_dsi_clk", STRING.MID("&clk", 1, &clk_input_length-2), 0)!=-1)
    ( 
      &match=1
    )
  )
  else if (&wild_head==1)
  (
    if (STRING.MID("gcc_mdss_mdp_dsi_clk", &clk_itr_length-&clk_input_length+1, &clk_input_length-1)==STRING.CUT("&clk", 1))
    ( 
      &match=1
    )
  )
  else if (&wild_tail==1)
  (
    if (STRING.MID("gcc_mdss_mdp_dsi_clk", 0, &clk_input_length-1)==STRING.CUT("&clk", -1))
    ( 
      &match=1
    )
  )	  
  else if ("gcc_mdss_mdp_dsi_clk"=="&clk")
  (
    &match=1
  )
  
  if (&match==1)
  (
    &clk_test=&CLK_TEST_GCC_MDSS_MDP_DSI_CLK
    &clk_reg=0
    &clk_reg_name="No CBCR"
    &clk_name="gcc_mdss_mdp_dsi_clk"
    &clk_reg_cbcr_type="gfmux"

    gosub Print_Clk_Info_Line
  )
  
  &match=0
  &wild_head=0
  &wild_tail=0
  &clk_input_length=STRING.LENGTH("&clk")
  &clk_itr_length=STRING.LENGTH("gcc_mdss_mdp_vbif_clk")

  if (STRING.SCAN("&clk", "*", 0)==0)
  (
    &wild_head=1
  )
  if (STRING.SCAN("&clk", "*", 1)==(STRING.LENGTH("&clk")-1))
  (
    &wild_tail=1
  )

  if ((&wild_head==1)&&(&wild_tail==1))
  (
    if (STRING.SCAN("gcc_mdss_mdp_vbif_clk", STRING.MID("&clk", 1, &clk_input_length-2), 0)!=-1)
    ( 
      &match=1
    )
  )
  else if (&wild_head==1)
  (
    if (STRING.MID("gcc_mdss_mdp_vbif_clk", &clk_itr_length-&clk_input_length+1, &clk_input_length-1)==STRING.CUT("&clk", 1))
    ( 
      &match=1
    )
  )
  else if (&wild_tail==1)
  (
    if (STRING.MID("gcc_mdss_mdp_vbif_clk", 0, &clk_input_length-1)==STRING.CUT("&clk", -1))
    ( 
      &match=1
    )
  )	  
  else if ("gcc_mdss_mdp_vbif_clk"=="&clk")
  (
    &match=1
  )
  
  if (&match==1)
  (
    &clk_test=&CLK_TEST_GCC_MDSS_MDP_VBIF_CLK
    &clk_reg=0
    &clk_reg_name="No CBCR"
    &clk_name="gcc_mdss_mdp_vbif_clk"
    &clk_reg_cbcr_type="sm_pscbc"

    gosub Print_Clk_Info_Line
  )
  
  &match=0
  &wild_head=0
  &wild_tail=0
  &clk_input_length=STRING.LENGTH("&clk")
  &clk_itr_length=STRING.LENGTH("gcc_mdss_pclk0_clk")

  if (STRING.SCAN("&clk", "*", 0)==0)
  (
    &wild_head=1
  )
  if (STRING.SCAN("&clk", "*", 1)==(STRING.LENGTH("&clk")-1))
  (
    &wild_tail=1
  )

  if ((&wild_head==1)&&(&wild_tail==1))
  (
    if (STRING.SCAN("gcc_mdss_pclk0_clk", STRING.MID("&clk", 1, &clk_input_length-2), 0)!=-1)
    ( 
      &match=1
    )
  )
  else if (&wild_head==1)
  (
    if (STRING.MID("gcc_mdss_pclk0_clk", &clk_itr_length-&clk_input_length+1, &clk_input_length-1)==STRING.CUT("&clk", 1))
    ( 
      &match=1
    )
  )
  else if (&wild_tail==1)
  (
    if (STRING.MID("gcc_mdss_pclk0_clk", 0, &clk_input_length-1)==STRING.CUT("&clk", -1))
    ( 
      &match=1
    )
  )	  
  else if ("gcc_mdss_pclk0_clk"=="&clk")
  (
    &match=1
  )
  
  if (&match==1)
  (
    &clk_test=&CLK_TEST_GCC_MDSS_PCLK0_CLK
    &clk_reg=&HWIO_GCC_MDSS_PCLK0_CBCR_ADDR
    &clk_reg_name="GCC_MDSS_PCLK0_CBCR"
    &clk_name="gcc_mdss_pclk0_clk"
    &clk_reg_cbcr_type="sm_cbc"

    gosub Print_Clk_Info_Line
  )
  
  &match=0
  &wild_head=0
  &wild_tail=0
  &clk_input_length=STRING.LENGTH("&clk")
  &clk_itr_length=STRING.LENGTH("gcc_mdss_qdss_at_clk")

  if (STRING.SCAN("&clk", "*", 0)==0)
  (
    &wild_head=1
  )
  if (STRING.SCAN("&clk", "*", 1)==(STRING.LENGTH("&clk")-1))
  (
    &wild_tail=1
  )

  if ((&wild_head==1)&&(&wild_tail==1))
  (
    if (STRING.SCAN("gcc_mdss_qdss_at_clk", STRING.MID("&clk", 1, &clk_input_length-2), 0)!=-1)
    ( 
      &match=1
    )
  )
  else if (&wild_head==1)
  (
    if (STRING.MID("gcc_mdss_qdss_at_clk", &clk_itr_length-&clk_input_length+1, &clk_input_length-1)==STRING.CUT("&clk", 1))
    ( 
      &match=1
    )
  )
  else if (&wild_tail==1)
  (
    if (STRING.MID("gcc_mdss_qdss_at_clk", 0, &clk_input_length-1)==STRING.CUT("&clk", -1))
    ( 
      &match=1
    )
  )	  
  else if ("gcc_mdss_qdss_at_clk"=="&clk")
  (
    &match=1
  )
  
  if (&match==1)
  (
    &clk_test=&CLK_TEST_GCC_MDSS_QDSS_AT_CLK
    &clk_reg=0
    &clk_reg_name="No CBCR"
    &clk_name="gcc_mdss_qdss_at_clk"
    &clk_reg_cbcr_type="cgc"

    gosub Print_Clk_Info_Line
  )
  
  &match=0
  &wild_head=0
  &wild_tail=0
  &clk_input_length=STRING.LENGTH("&clk")
  &clk_itr_length=STRING.LENGTH("gcc_mdss_qdss_tsctr_div8_clk")

  if (STRING.SCAN("&clk", "*", 0)==0)
  (
    &wild_head=1
  )
  if (STRING.SCAN("&clk", "*", 1)==(STRING.LENGTH("&clk")-1))
  (
    &wild_tail=1
  )

  if ((&wild_head==1)&&(&wild_tail==1))
  (
    if (STRING.SCAN("gcc_mdss_qdss_tsctr_div8_clk", STRING.MID("&clk", 1, &clk_input_length-2), 0)!=-1)
    ( 
      &match=1
    )
  )
  else if (&wild_head==1)
  (
    if (STRING.MID("gcc_mdss_qdss_tsctr_div8_clk", &clk_itr_length-&clk_input_length+1, &clk_input_length-1)==STRING.CUT("&clk", 1))
    ( 
      &match=1
    )
  )
  else if (&wild_tail==1)
  (
    if (STRING.MID("gcc_mdss_qdss_tsctr_div8_clk", 0, &clk_input_length-1)==STRING.CUT("&clk", -1))
    ( 
      &match=1
    )
  )	  
  else if ("gcc_mdss_qdss_tsctr_div8_clk"=="&clk")
  (
    &match=1
  )
  
  if (&match==1)
  (
    &clk_test=&CLK_TEST_GCC_MDSS_QDSS_TSCTR_DIV8_CLK
    &clk_reg=0
    &clk_reg_name="No CBCR"
    &clk_name="gcc_mdss_qdss_tsctr_div8_clk"
    &clk_reg_cbcr_type="cgc"

    gosub Print_Clk_Info_Line
  )
  
  &match=0
  &wild_head=0
  &wild_tail=0
  &clk_input_length=STRING.LENGTH("&clk")
  &clk_itr_length=STRING.LENGTH("gcc_mdss_vsync_clk")

  if (STRING.SCAN("&clk", "*", 0)==0)
  (
    &wild_head=1
  )
  if (STRING.SCAN("&clk", "*", 1)==(STRING.LENGTH("&clk")-1))
  (
    &wild_tail=1
  )

  if ((&wild_head==1)&&(&wild_tail==1))
  (
    if (STRING.SCAN("gcc_mdss_vsync_clk", STRING.MID("&clk", 1, &clk_input_length-2), 0)!=-1)
    ( 
      &match=1
    )
  )
  else if (&wild_head==1)
  (
    if (STRING.MID("gcc_mdss_vsync_clk", &clk_itr_length-&clk_input_length+1, &clk_input_length-1)==STRING.CUT("&clk", 1))
    ( 
      &match=1
    )
  )
  else if (&wild_tail==1)
  (
    if (STRING.MID("gcc_mdss_vsync_clk", 0, &clk_input_length-1)==STRING.CUT("&clk", -1))
    ( 
      &match=1
    )
  )	  
  else if ("gcc_mdss_vsync_clk"=="&clk")
  (
    &match=1
  )
  
  if (&match==1)
  (
    &clk_test=&CLK_TEST_GCC_MDSS_VSYNC_CLK
    &clk_reg=&HWIO_GCC_MDSS_VSYNC_CBCR_ADDR
    &clk_reg_name="GCC_MDSS_VSYNC_CBCR"
    &clk_name="gcc_mdss_vsync_clk"
    &clk_reg_cbcr_type="sm_cbc"

    gosub Print_Clk_Info_Line
  )
  
  &match=0
  &wild_head=0
  &wild_tail=0
  &clk_input_length=STRING.LENGTH("&clk")
  &clk_itr_length=STRING.LENGTH("gcc_mpm_ahb_clk")

  if (STRING.SCAN("&clk", "*", 0)==0)
  (
    &wild_head=1
  )
  if (STRING.SCAN("&clk", "*", 1)==(STRING.LENGTH("&clk")-1))
  (
    &wild_tail=1
  )

  if ((&wild_head==1)&&(&wild_tail==1))
  (
    if (STRING.SCAN("gcc_mpm_ahb_clk", STRING.MID("&clk", 1, &clk_input_length-2), 0)!=-1)
    ( 
      &match=1
    )
  )
  else if (&wild_head==1)
  (
    if (STRING.MID("gcc_mpm_ahb_clk", &clk_itr_length-&clk_input_length+1, &clk_input_length-1)==STRING.CUT("&clk", 1))
    ( 
      &match=1
    )
  )
  else if (&wild_tail==1)
  (
    if (STRING.MID("gcc_mpm_ahb_clk", 0, &clk_input_length-1)==STRING.CUT("&clk", -1))
    ( 
      &match=1
    )
  )	  
  else if ("gcc_mpm_ahb_clk"=="&clk")
  (
    &match=1
  )
  
  if (&match==1)
  (
    &clk_test=&CLK_TEST_GCC_MPM_AHB_CLK
    &clk_reg=&HWIO_GCC_MPM_AHB_CBCR_ADDR
    &clk_reg_name="GCC_MPM_AHB_CBCR"
    &clk_name="gcc_mpm_ahb_clk"
    &clk_reg_cbcr_type="sm_cbc"

    gosub Print_Clk_Info_Line
  )
  
  &match=0
  &wild_head=0
  &wild_tail=0
  &clk_input_length=STRING.LENGTH("&clk")
  &clk_itr_length=STRING.LENGTH("gcc_msg_ram_ahb_clk")

  if (STRING.SCAN("&clk", "*", 0)==0)
  (
    &wild_head=1
  )
  if (STRING.SCAN("&clk", "*", 1)==(STRING.LENGTH("&clk")-1))
  (
    &wild_tail=1
  )

  if ((&wild_head==1)&&(&wild_tail==1))
  (
    if (STRING.SCAN("gcc_msg_ram_ahb_clk", STRING.MID("&clk", 1, &clk_input_length-2), 0)!=-1)
    ( 
      &match=1
    )
  )
  else if (&wild_head==1)
  (
    if (STRING.MID("gcc_msg_ram_ahb_clk", &clk_itr_length-&clk_input_length+1, &clk_input_length-1)==STRING.CUT("&clk", 1))
    ( 
      &match=1
    )
  )
  else if (&wild_tail==1)
  (
    if (STRING.MID("gcc_msg_ram_ahb_clk", 0, &clk_input_length-1)==STRING.CUT("&clk", -1))
    ( 
      &match=1
    )
  )	  
  else if ("gcc_msg_ram_ahb_clk"=="&clk")
  (
    &match=1
  )
  
  if (&match==1)
  (
    &clk_test=&CLK_TEST_GCC_MSG_RAM_AHB_CLK
    &clk_reg=&HWIO_GCC_MSG_RAM_AHB_CBCR_ADDR
    &clk_reg_name="GCC_MSG_RAM_AHB_CBCR"
    &clk_name="gcc_msg_ram_ahb_clk"
    &clk_reg_cbcr_type="sm_pscbc"

    gosub Print_Clk_Info_Line
  )
  
  &match=0
  &wild_head=0
  &wild_tail=0
  &clk_input_length=STRING.LENGTH("&clk")
  &clk_itr_length=STRING.LENGTH("gcc_mss_cfg_ahb_clk")

  if (STRING.SCAN("&clk", "*", 0)==0)
  (
    &wild_head=1
  )
  if (STRING.SCAN("&clk", "*", 1)==(STRING.LENGTH("&clk")-1))
  (
    &wild_tail=1
  )

  if ((&wild_head==1)&&(&wild_tail==1))
  (
    if (STRING.SCAN("gcc_mss_cfg_ahb_clk", STRING.MID("&clk", 1, &clk_input_length-2), 0)!=-1)
    ( 
      &match=1
    )
  )
  else if (&wild_head==1)
  (
    if (STRING.MID("gcc_mss_cfg_ahb_clk", &clk_itr_length-&clk_input_length+1, &clk_input_length-1)==STRING.CUT("&clk", 1))
    ( 
      &match=1
    )
  )
  else if (&wild_tail==1)
  (
    if (STRING.MID("gcc_mss_cfg_ahb_clk", 0, &clk_input_length-1)==STRING.CUT("&clk", -1))
    ( 
      &match=1
    )
  )	  
  else if ("gcc_mss_cfg_ahb_clk"=="&clk")
  (
    &match=1
  )
  
  if (&match==1)
  (
    &clk_test=&CLK_TEST_GCC_MSS_CFG_AHB_CLK
    &clk_reg=&HWIO_GCC_MSS_CFG_AHB_CBCR_ADDR
    &clk_reg_name="GCC_MSS_CFG_AHB_CBCR"
    &clk_name="gcc_mss_cfg_ahb_clk"
    &clk_reg_cbcr_type="sm_cbc"

    gosub Print_Clk_Info_Line
  )
  
  &match=0
  &wild_head=0
  &wild_tail=0
  &clk_input_length=STRING.LENGTH("&clk")
  &clk_itr_length=STRING.LENGTH("gcc_mss_q6_bimc_axi_clk")

  if (STRING.SCAN("&clk", "*", 0)==0)
  (
    &wild_head=1
  )
  if (STRING.SCAN("&clk", "*", 1)==(STRING.LENGTH("&clk")-1))
  (
    &wild_tail=1
  )

  if ((&wild_head==1)&&(&wild_tail==1))
  (
    if (STRING.SCAN("gcc_mss_q6_bimc_axi_clk", STRING.MID("&clk", 1, &clk_input_length-2), 0)!=-1)
    ( 
      &match=1
    )
  )
  else if (&wild_head==1)
  (
    if (STRING.MID("gcc_mss_q6_bimc_axi_clk", &clk_itr_length-&clk_input_length+1, &clk_input_length-1)==STRING.CUT("&clk", 1))
    ( 
      &match=1
    )
  )
  else if (&wild_tail==1)
  (
    if (STRING.MID("gcc_mss_q6_bimc_axi_clk", 0, &clk_input_length-1)==STRING.CUT("&clk", -1))
    ( 
      &match=1
    )
  )	  
  else if ("gcc_mss_q6_bimc_axi_clk"=="&clk")
  (
    &match=1
  )
  
  if (&match==1)
  (
    &clk_test=&CLK_TEST_GCC_MSS_Q6_BIMC_AXI_CLK
    &clk_reg=&HWIO_GCC_MSS_Q6_BIMC_AXI_CBCR_ADDR
    &clk_reg_name="GCC_MSS_Q6_BIMC_AXI_CBCR"
    &clk_name="gcc_mss_q6_bimc_axi_clk"
    &clk_reg_cbcr_type="sm_cbc"

    gosub Print_Clk_Info_Line
  )
  
  &match=0
  &wild_head=0
  &wild_tail=0
  &clk_input_length=STRING.LENGTH("&clk")
  &clk_itr_length=STRING.LENGTH("mss_gcc_dbg_clk")

  if (STRING.SCAN("&clk", "*", 0)==0)
  (
    &wild_head=1
  )
  if (STRING.SCAN("&clk", "*", 1)==(STRING.LENGTH("&clk")-1))
  (
    &wild_tail=1
  )

  if ((&wild_head==1)&&(&wild_tail==1))
  (
    if (STRING.SCAN("mss_gcc_dbg_clk", STRING.MID("&clk", 1, &clk_input_length-2), 0)!=-1)
    ( 
      &match=1
    )
  )
  else if (&wild_head==1)
  (
    if (STRING.MID("mss_gcc_dbg_clk", &clk_itr_length-&clk_input_length+1, &clk_input_length-1)==STRING.CUT("&clk", 1))
    ( 
      &match=1
    )
  )
  else if (&wild_tail==1)
  (
    if (STRING.MID("mss_gcc_dbg_clk", 0, &clk_input_length-1)==STRING.CUT("&clk", -1))
    ( 
      &match=1
    )
  )	  
  else if ("mss_gcc_dbg_clk"=="&clk")
  (
    &match=1
  )
  
  if (&match==1)
  (
    &clk_test=&CLK_TEST_MSS_GCC_DBG_CLK
    &clk_reg=0
    &clk_reg_name="No CBCR"
    &clk_name="mss_gcc_dbg_clk"
    &clk_reg_cbcr_type="ext"

    gosub Print_Clk_Info_Line
  )
  
  &match=0
  &wild_head=0
  &wild_tail=0
  &clk_input_length=STRING.LENGTH("&clk")
  &clk_itr_length=STRING.LENGTH("gcc_noc_conf_xpu_ahb_clk")

  if (STRING.SCAN("&clk", "*", 0)==0)
  (
    &wild_head=1
  )
  if (STRING.SCAN("&clk", "*", 1)==(STRING.LENGTH("&clk")-1))
  (
    &wild_tail=1
  )

  if ((&wild_head==1)&&(&wild_tail==1))
  (
    if (STRING.SCAN("gcc_noc_conf_xpu_ahb_clk", STRING.MID("&clk", 1, &clk_input_length-2), 0)!=-1)
    ( 
      &match=1
    )
  )
  else if (&wild_head==1)
  (
    if (STRING.MID("gcc_noc_conf_xpu_ahb_clk", &clk_itr_length-&clk_input_length+1, &clk_input_length-1)==STRING.CUT("&clk", 1))
    ( 
      &match=1
    )
  )
  else if (&wild_tail==1)
  (
    if (STRING.MID("gcc_noc_conf_xpu_ahb_clk", 0, &clk_input_length-1)==STRING.CUT("&clk", -1))
    ( 
      &match=1
    )
  )	  
  else if ("gcc_noc_conf_xpu_ahb_clk"=="&clk")
  (
    &match=1
  )
  
  if (&match==1)
  (
    &clk_test=&CLK_TEST_GCC_NOC_CONF_XPU_AHB_CLK
    &clk_reg=&HWIO_GCC_NOC_CONF_XPU_AHB_CBCR_ADDR
    &clk_reg_name="GCC_NOC_CONF_XPU_AHB_CBCR"
    &clk_name="gcc_noc_conf_xpu_ahb_clk"
    &clk_reg_cbcr_type="sm_cbc"

    gosub Print_Clk_Info_Line
  )
  
  &match=0
  &wild_head=0
  &wild_tail=0
  &clk_input_length=STRING.LENGTH("&clk")
  &clk_itr_length=STRING.LENGTH("apss_gcc_ringosc_clk")

  if (STRING.SCAN("&clk", "*", 0)==0)
  (
    &wild_head=1
  )
  if (STRING.SCAN("&clk", "*", 1)==(STRING.LENGTH("&clk")-1))
  (
    &wild_tail=1
  )

  if ((&wild_head==1)&&(&wild_tail==1))
  (
    if (STRING.SCAN("apss_gcc_ringosc_clk", STRING.MID("&clk", 1, &clk_input_length-2), 0)!=-1)
    ( 
      &match=1
    )
  )
  else if (&wild_head==1)
  (
    if (STRING.MID("apss_gcc_ringosc_clk", &clk_itr_length-&clk_input_length+1, &clk_input_length-1)==STRING.CUT("&clk", 1))
    ( 
      &match=1
    )
  )
  else if (&wild_tail==1)
  (
    if (STRING.MID("apss_gcc_ringosc_clk", 0, &clk_input_length-1)==STRING.CUT("&clk", -1))
    ( 
      &match=1
    )
  )	  
  else if ("apss_gcc_ringosc_clk"=="&clk")
  (
    &match=1
  )
  
  if (&match==1)
  (
    &clk_test=&CLK_TEST_APSS_GCC_RINGOSC_CLK
    &clk_reg=0
    &clk_reg_name="No CBCR"
    &clk_name="apss_gcc_ringosc_clk"
    &clk_reg_cbcr_type="ext"

    gosub Print_Clk_Info_Line
  )
  
  &match=0
  &wild_head=0
  &wild_tail=0
  &clk_input_length=STRING.LENGTH("&clk")
  &clk_itr_length=STRING.LENGTH("bimc_pll_dtest")

  if (STRING.SCAN("&clk", "*", 0)==0)
  (
    &wild_head=1
  )
  if (STRING.SCAN("&clk", "*", 1)==(STRING.LENGTH("&clk")-1))
  (
    &wild_tail=1
  )

  if ((&wild_head==1)&&(&wild_tail==1))
  (
    if (STRING.SCAN("bimc_pll_dtest", STRING.MID("&clk", 1, &clk_input_length-2), 0)!=-1)
    ( 
      &match=1
    )
  )
  else if (&wild_head==1)
  (
    if (STRING.MID("bimc_pll_dtest", &clk_itr_length-&clk_input_length+1, &clk_input_length-1)==STRING.CUT("&clk", 1))
    ( 
      &match=1
    )
  )
  else if (&wild_tail==1)
  (
    if (STRING.MID("bimc_pll_dtest", 0, &clk_input_length-1)==STRING.CUT("&clk", -1))
    ( 
      &match=1
    )
  )	  
  else if ("bimc_pll_dtest"=="&clk")
  (
    &match=1
  )
  
  if (&match==1)
  (
    &clk_test=&CLK_TEST_BIMC_PLL_DTEST
    &clk_reg=0
    &clk_reg_name="No CBCR"
    &clk_name="bimc_pll_dtest"
    &clk_reg_cbcr_type="pll_test_data"

    gosub Print_Clk_Info_Line
  )
  
  &match=0
  &wild_head=0
  &wild_tail=0
  &clk_input_length=STRING.LENGTH("&clk")
  &clk_itr_length=STRING.LENGTH("bimc_pll_lock_det")

  if (STRING.SCAN("&clk", "*", 0)==0)
  (
    &wild_head=1
  )
  if (STRING.SCAN("&clk", "*", 1)==(STRING.LENGTH("&clk")-1))
  (
    &wild_tail=1
  )

  if ((&wild_head==1)&&(&wild_tail==1))
  (
    if (STRING.SCAN("bimc_pll_lock_det", STRING.MID("&clk", 1, &clk_input_length-2), 0)!=-1)
    ( 
      &match=1
    )
  )
  else if (&wild_head==1)
  (
    if (STRING.MID("bimc_pll_lock_det", &clk_itr_length-&clk_input_length+1, &clk_input_length-1)==STRING.CUT("&clk", 1))
    ( 
      &match=1
    )
  )
  else if (&wild_tail==1)
  (
    if (STRING.MID("bimc_pll_lock_det", 0, &clk_input_length-1)==STRING.CUT("&clk", -1))
    ( 
      &match=1
    )
  )	  
  else if ("bimc_pll_lock_det"=="&clk")
  (
    &match=1
  )
  
  if (&match==1)
  (
    &clk_test=&CLK_TEST_BIMC_PLL_LOCK_DET
    &clk_reg=0
    &clk_reg_name="No CBCR"
    &clk_name="bimc_pll_lock_det"
    &clk_reg_cbcr_type="pll_test_data"

    gosub Print_Clk_Info_Line
  )
  
  &match=0
  &wild_head=0
  &wild_tail=0
  &clk_input_length=STRING.LENGTH("&clk")
  &clk_itr_length=STRING.LENGTH("gpll0_dtest")

  if (STRING.SCAN("&clk", "*", 0)==0)
  (
    &wild_head=1
  )
  if (STRING.SCAN("&clk", "*", 1)==(STRING.LENGTH("&clk")-1))
  (
    &wild_tail=1
  )

  if ((&wild_head==1)&&(&wild_tail==1))
  (
    if (STRING.SCAN("gpll0_dtest", STRING.MID("&clk", 1, &clk_input_length-2), 0)!=-1)
    ( 
      &match=1
    )
  )
  else if (&wild_head==1)
  (
    if (STRING.MID("gpll0_dtest", &clk_itr_length-&clk_input_length+1, &clk_input_length-1)==STRING.CUT("&clk", 1))
    ( 
      &match=1
    )
  )
  else if (&wild_tail==1)
  (
    if (STRING.MID("gpll0_dtest", 0, &clk_input_length-1)==STRING.CUT("&clk", -1))
    ( 
      &match=1
    )
  )	  
  else if ("gpll0_dtest"=="&clk")
  (
    &match=1
  )
  
  if (&match==1)
  (
    &clk_test=&CLK_TEST_GPLL0_DTEST
    &clk_reg=0
    &clk_reg_name="No CBCR"
    &clk_name="gpll0_dtest"
    &clk_reg_cbcr_type="pll_test_data"

    gosub Print_Clk_Info_Line
  )
  
  &match=0
  &wild_head=0
  &wild_tail=0
  &clk_input_length=STRING.LENGTH("&clk")
  &clk_itr_length=STRING.LENGTH("gpll0_lock_det")

  if (STRING.SCAN("&clk", "*", 0)==0)
  (
    &wild_head=1
  )
  if (STRING.SCAN("&clk", "*", 1)==(STRING.LENGTH("&clk")-1))
  (
    &wild_tail=1
  )

  if ((&wild_head==1)&&(&wild_tail==1))
  (
    if (STRING.SCAN("gpll0_lock_det", STRING.MID("&clk", 1, &clk_input_length-2), 0)!=-1)
    ( 
      &match=1
    )
  )
  else if (&wild_head==1)
  (
    if (STRING.MID("gpll0_lock_det", &clk_itr_length-&clk_input_length+1, &clk_input_length-1)==STRING.CUT("&clk", 1))
    ( 
      &match=1
    )
  )
  else if (&wild_tail==1)
  (
    if (STRING.MID("gpll0_lock_det", 0, &clk_input_length-1)==STRING.CUT("&clk", -1))
    ( 
      &match=1
    )
  )	  
  else if ("gpll0_lock_det"=="&clk")
  (
    &match=1
  )
  
  if (&match==1)
  (
    &clk_test=&CLK_TEST_GPLL0_LOCK_DET
    &clk_reg=0
    &clk_reg_name="No CBCR"
    &clk_name="gpll0_lock_det"
    &clk_reg_cbcr_type="pll_test_data"

    gosub Print_Clk_Info_Line
  )
  
  &match=0
  &wild_head=0
  &wild_tail=0
  &clk_input_length=STRING.LENGTH("&clk")
  &clk_itr_length=STRING.LENGTH("gpll1_dtest")

  if (STRING.SCAN("&clk", "*", 0)==0)
  (
    &wild_head=1
  )
  if (STRING.SCAN("&clk", "*", 1)==(STRING.LENGTH("&clk")-1))
  (
    &wild_tail=1
  )

  if ((&wild_head==1)&&(&wild_tail==1))
  (
    if (STRING.SCAN("gpll1_dtest", STRING.MID("&clk", 1, &clk_input_length-2), 0)!=-1)
    ( 
      &match=1
    )
  )
  else if (&wild_head==1)
  (
    if (STRING.MID("gpll1_dtest", &clk_itr_length-&clk_input_length+1, &clk_input_length-1)==STRING.CUT("&clk", 1))
    ( 
      &match=1
    )
  )
  else if (&wild_tail==1)
  (
    if (STRING.MID("gpll1_dtest", 0, &clk_input_length-1)==STRING.CUT("&clk", -1))
    ( 
      &match=1
    )
  )	  
  else if ("gpll1_dtest"=="&clk")
  (
    &match=1
  )
  
  if (&match==1)
  (
    &clk_test=&CLK_TEST_GPLL1_DTEST
    &clk_reg=0
    &clk_reg_name="No CBCR"
    &clk_name="gpll1_dtest"
    &clk_reg_cbcr_type="pll_test_data"

    gosub Print_Clk_Info_Line
  )
  
  &match=0
  &wild_head=0
  &wild_tail=0
  &clk_input_length=STRING.LENGTH("&clk")
  &clk_itr_length=STRING.LENGTH("gpll1_lock_det")

  if (STRING.SCAN("&clk", "*", 0)==0)
  (
    &wild_head=1
  )
  if (STRING.SCAN("&clk", "*", 1)==(STRING.LENGTH("&clk")-1))
  (
    &wild_tail=1
  )

  if ((&wild_head==1)&&(&wild_tail==1))
  (
    if (STRING.SCAN("gpll1_lock_det", STRING.MID("&clk", 1, &clk_input_length-2), 0)!=-1)
    ( 
      &match=1
    )
  )
  else if (&wild_head==1)
  (
    if (STRING.MID("gpll1_lock_det", &clk_itr_length-&clk_input_length+1, &clk_input_length-1)==STRING.CUT("&clk", 1))
    ( 
      &match=1
    )
  )
  else if (&wild_tail==1)
  (
    if (STRING.MID("gpll1_lock_det", 0, &clk_input_length-1)==STRING.CUT("&clk", -1))
    ( 
      &match=1
    )
  )	  
  else if ("gpll1_lock_det"=="&clk")
  (
    &match=1
  )
  
  if (&match==1)
  (
    &clk_test=&CLK_TEST_GPLL1_LOCK_DET
    &clk_reg=0
    &clk_reg_name="No CBCR"
    &clk_name="gpll1_lock_det"
    &clk_reg_cbcr_type="pll_test_data"

    gosub Print_Clk_Info_Line
  )
  
  &match=0
  &wild_head=0
  &wild_tail=0
  &clk_input_length=STRING.LENGTH("&clk")
  &clk_itr_length=STRING.LENGTH("mpm_gcc_temp_sensor_ringosc_clk")

  if (STRING.SCAN("&clk", "*", 0)==0)
  (
    &wild_head=1
  )
  if (STRING.SCAN("&clk", "*", 1)==(STRING.LENGTH("&clk")-1))
  (
    &wild_tail=1
  )

  if ((&wild_head==1)&&(&wild_tail==1))
  (
    if (STRING.SCAN("mpm_gcc_temp_sensor_ringosc_clk", STRING.MID("&clk", 1, &clk_input_length-2), 0)!=-1)
    ( 
      &match=1
    )
  )
  else if (&wild_head==1)
  (
    if (STRING.MID("mpm_gcc_temp_sensor_ringosc_clk", &clk_itr_length-&clk_input_length+1, &clk_input_length-1)==STRING.CUT("&clk", 1))
    ( 
      &match=1
    )
  )
  else if (&wild_tail==1)
  (
    if (STRING.MID("mpm_gcc_temp_sensor_ringosc_clk", 0, &clk_input_length-1)==STRING.CUT("&clk", -1))
    ( 
      &match=1
    )
  )	  
  else if ("mpm_gcc_temp_sensor_ringosc_clk"=="&clk")
  (
    &match=1
  )
  
  if (&match==1)
  (
    &clk_test=&CLK_TEST_MPM_GCC_TEMP_SENSOR_RINGOSC_CLK
    &clk_reg=0
    &clk_reg_name="No CBCR"
    &clk_name="mpm_gcc_temp_sensor_ringosc_clk"
    &clk_reg_cbcr_type="ext"

    gosub Print_Clk_Info_Line
  )
  
  &match=0
  &wild_head=0
  &wild_tail=0
  &clk_input_length=STRING.LENGTH("&clk")
  &clk_itr_length=STRING.LENGTH("usb2_phy_gcc_atest_ulpi_0_clk")

  if (STRING.SCAN("&clk", "*", 0)==0)
  (
    &wild_head=1
  )
  if (STRING.SCAN("&clk", "*", 1)==(STRING.LENGTH("&clk")-1))
  (
    &wild_tail=1
  )

  if ((&wild_head==1)&&(&wild_tail==1))
  (
    if (STRING.SCAN("usb2_phy_gcc_atest_ulpi_0_clk", STRING.MID("&clk", 1, &clk_input_length-2), 0)!=-1)
    ( 
      &match=1
    )
  )
  else if (&wild_head==1)
  (
    if (STRING.MID("usb2_phy_gcc_atest_ulpi_0_clk", &clk_itr_length-&clk_input_length+1, &clk_input_length-1)==STRING.CUT("&clk", 1))
    ( 
      &match=1
    )
  )
  else if (&wild_tail==1)
  (
    if (STRING.MID("usb2_phy_gcc_atest_ulpi_0_clk", 0, &clk_input_length-1)==STRING.CUT("&clk", -1))
    ( 
      &match=1
    )
  )	  
  else if ("usb2_phy_gcc_atest_ulpi_0_clk"=="&clk")
  (
    &match=1
  )
  
  if (&match==1)
  (
    &clk_test=&CLK_TEST_USB2_PHY_GCC_ATEST_ULPI_0_CLK
    &clk_reg=0
    &clk_reg_name="No CBCR"
    &clk_name="usb2_phy_gcc_atest_ulpi_0_clk"
    &clk_reg_cbcr_type="ext"

    gosub Print_Clk_Info_Line
  )
  
  &match=0
  &wild_head=0
  &wild_tail=0
  &clk_input_length=STRING.LENGTH("&clk")
  &clk_itr_length=STRING.LENGTH("usb2_phy_gcc_atest_ulpi_1_clk")

  if (STRING.SCAN("&clk", "*", 0)==0)
  (
    &wild_head=1
  )
  if (STRING.SCAN("&clk", "*", 1)==(STRING.LENGTH("&clk")-1))
  (
    &wild_tail=1
  )

  if ((&wild_head==1)&&(&wild_tail==1))
  (
    if (STRING.SCAN("usb2_phy_gcc_atest_ulpi_1_clk", STRING.MID("&clk", 1, &clk_input_length-2), 0)!=-1)
    ( 
      &match=1
    )
  )
  else if (&wild_head==1)
  (
    if (STRING.MID("usb2_phy_gcc_atest_ulpi_1_clk", &clk_itr_length-&clk_input_length+1, &clk_input_length-1)==STRING.CUT("&clk", 1))
    ( 
      &match=1
    )
  )
  else if (&wild_tail==1)
  (
    if (STRING.MID("usb2_phy_gcc_atest_ulpi_1_clk", 0, &clk_input_length-1)==STRING.CUT("&clk", -1))
    ( 
      &match=1
    )
  )	  
  else if ("usb2_phy_gcc_atest_ulpi_1_clk"=="&clk")
  (
    &match=1
  )
  
  if (&match==1)
  (
    &clk_test=&CLK_TEST_USB2_PHY_GCC_ATEST_ULPI_1_CLK
    &clk_reg=0
    &clk_reg_name="No CBCR"
    &clk_name="usb2_phy_gcc_atest_ulpi_1_clk"
    &clk_reg_cbcr_type="ext"

    gosub Print_Clk_Info_Line
  )
  
  &match=0
  &wild_head=0
  &wild_tail=0
  &clk_input_length=STRING.LENGTH("&clk")
  &clk_itr_length=STRING.LENGTH("wcss_gcc_dbg_clk")

  if (STRING.SCAN("&clk", "*", 0)==0)
  (
    &wild_head=1
  )
  if (STRING.SCAN("&clk", "*", 1)==(STRING.LENGTH("&clk")-1))
  (
    &wild_tail=1
  )

  if ((&wild_head==1)&&(&wild_tail==1))
  (
    if (STRING.SCAN("wcss_gcc_dbg_clk", STRING.MID("&clk", 1, &clk_input_length-2), 0)!=-1)
    ( 
      &match=1
    )
  )
  else if (&wild_head==1)
  (
    if (STRING.MID("wcss_gcc_dbg_clk", &clk_itr_length-&clk_input_length+1, &clk_input_length-1)==STRING.CUT("&clk", 1))
    ( 
      &match=1
    )
  )
  else if (&wild_tail==1)
  (
    if (STRING.MID("wcss_gcc_dbg_clk", 0, &clk_input_length-1)==STRING.CUT("&clk", -1))
    ( 
      &match=1
    )
  )	  
  else if ("wcss_gcc_dbg_clk"=="&clk")
  (
    &match=1
  )
  
  if (&match==1)
  (
    &clk_test=&CLK_TEST_WCSS_GCC_DBG_CLK
    &clk_reg=0
    &clk_reg_name="No CBCR"
    &clk_name="wcss_gcc_dbg_clk"
    &clk_reg_cbcr_type="ext"

    gosub Print_Clk_Info_Line
  )
  
  &match=0
  &wild_head=0
  &wild_tail=0
  &clk_input_length=STRING.LENGTH("&clk")
  &clk_itr_length=STRING.LENGTH("gcc_bimc_gfx_clk")

  if (STRING.SCAN("&clk", "*", 0)==0)
  (
    &wild_head=1
  )
  if (STRING.SCAN("&clk", "*", 1)==(STRING.LENGTH("&clk")-1))
  (
    &wild_tail=1
  )

  if ((&wild_head==1)&&(&wild_tail==1))
  (
    if (STRING.SCAN("gcc_bimc_gfx_clk", STRING.MID("&clk", 1, &clk_input_length-2), 0)!=-1)
    ( 
      &match=1
    )
  )
  else if (&wild_head==1)
  (
    if (STRING.MID("gcc_bimc_gfx_clk", &clk_itr_length-&clk_input_length+1, &clk_input_length-1)==STRING.CUT("&clk", 1))
    ( 
      &match=1
    )
  )
  else if (&wild_tail==1)
  (
    if (STRING.MID("gcc_bimc_gfx_clk", 0, &clk_input_length-1)==STRING.CUT("&clk", -1))
    ( 
      &match=1
    )
  )	  
  else if ("gcc_bimc_gfx_clk"=="&clk")
  (
    &match=1
  )
  
  if (&match==1)
  (
    &clk_test=&CLK_TEST_GCC_BIMC_GFX_CLK
    &clk_reg=&HWIO_GCC_BIMC_GFX_CBCR_ADDR
    &clk_reg_name="GCC_BIMC_GFX_CBCR"
    &clk_name="gcc_bimc_gfx_clk"
    &clk_reg_cbcr_type="sm_pscbc"

    gosub Print_Clk_Info_Line
  )
  
  &match=0
  &wild_head=0
  &wild_tail=0
  &clk_input_length=STRING.LENGTH("&clk")
  &clk_itr_length=STRING.LENGTH("gcc_oxili_ahb_clk")

  if (STRING.SCAN("&clk", "*", 0)==0)
  (
    &wild_head=1
  )
  if (STRING.SCAN("&clk", "*", 1)==(STRING.LENGTH("&clk")-1))
  (
    &wild_tail=1
  )

  if ((&wild_head==1)&&(&wild_tail==1))
  (
    if (STRING.SCAN("gcc_oxili_ahb_clk", STRING.MID("&clk", 1, &clk_input_length-2), 0)!=-1)
    ( 
      &match=1
    )
  )
  else if (&wild_head==1)
  (
    if (STRING.MID("gcc_oxili_ahb_clk", &clk_itr_length-&clk_input_length+1, &clk_input_length-1)==STRING.CUT("&clk", 1))
    ( 
      &match=1
    )
  )
  else if (&wild_tail==1)
  (
    if (STRING.MID("gcc_oxili_ahb_clk", 0, &clk_input_length-1)==STRING.CUT("&clk", -1))
    ( 
      &match=1
    )
  )	  
  else if ("gcc_oxili_ahb_clk"=="&clk")
  (
    &match=1
  )
  
  if (&match==1)
  (
    &clk_test=&CLK_TEST_GCC_OXILI_AHB_CLK
    &clk_reg=&HWIO_GCC_OXILI_AHB_CBCR_ADDR
    &clk_reg_name="GCC_OXILI_AHB_CBCR"
    &clk_name="gcc_oxili_ahb_clk"
    &clk_reg_cbcr_type="sm_cbc"

    gosub Print_Clk_Info_Line
  )
  
  &match=0
  &wild_head=0
  &wild_tail=0
  &clk_input_length=STRING.LENGTH("&clk")
  &clk_itr_length=STRING.LENGTH("gcc_oxili_gfx3d_clk")

  if (STRING.SCAN("&clk", "*", 0)==0)
  (
    &wild_head=1
  )
  if (STRING.SCAN("&clk", "*", 1)==(STRING.LENGTH("&clk")-1))
  (
    &wild_tail=1
  )

  if ((&wild_head==1)&&(&wild_tail==1))
  (
    if (STRING.SCAN("gcc_oxili_gfx3d_clk", STRING.MID("&clk", 1, &clk_input_length-2), 0)!=-1)
    ( 
      &match=1
    )
  )
  else if (&wild_head==1)
  (
    if (STRING.MID("gcc_oxili_gfx3d_clk", &clk_itr_length-&clk_input_length+1, &clk_input_length-1)==STRING.CUT("&clk", 1))
    ( 
      &match=1
    )
  )
  else if (&wild_tail==1)
  (
    if (STRING.MID("gcc_oxili_gfx3d_clk", 0, &clk_input_length-1)==STRING.CUT("&clk", -1))
    ( 
      &match=1
    )
  )	  
  else if ("gcc_oxili_gfx3d_clk"=="&clk")
  (
    &match=1
  )
  
  if (&match==1)
  (
    &clk_test=&CLK_TEST_GCC_OXILI_GFX3D_CLK
    &clk_reg=&HWIO_GCC_OXILI_GFX3D_CBCR_ADDR
    &clk_reg_name="GCC_OXILI_GFX3D_CBCR"
    &clk_name="gcc_oxili_gfx3d_clk"
    &clk_reg_cbcr_type="sm_pscbc"

    gosub Print_Clk_Info_Line
  )
  
  &match=0
  &wild_head=0
  &wild_tail=0
  &clk_input_length=STRING.LENGTH("&clk")
  &clk_itr_length=STRING.LENGTH("gcc_oxili_qdss_at_clk")

  if (STRING.SCAN("&clk", "*", 0)==0)
  (
    &wild_head=1
  )
  if (STRING.SCAN("&clk", "*", 1)==(STRING.LENGTH("&clk")-1))
  (
    &wild_tail=1
  )

  if ((&wild_head==1)&&(&wild_tail==1))
  (
    if (STRING.SCAN("gcc_oxili_qdss_at_clk", STRING.MID("&clk", 1, &clk_input_length-2), 0)!=-1)
    ( 
      &match=1
    )
  )
  else if (&wild_head==1)
  (
    if (STRING.MID("gcc_oxili_qdss_at_clk", &clk_itr_length-&clk_input_length+1, &clk_input_length-1)==STRING.CUT("&clk", 1))
    ( 
      &match=1
    )
  )
  else if (&wild_tail==1)
  (
    if (STRING.MID("gcc_oxili_qdss_at_clk", 0, &clk_input_length-1)==STRING.CUT("&clk", -1))
    ( 
      &match=1
    )
  )	  
  else if ("gcc_oxili_qdss_at_clk"=="&clk")
  (
    &match=1
  )
  
  if (&match==1)
  (
    &clk_test=&CLK_TEST_GCC_OXILI_QDSS_AT_CLK
    &clk_reg=0
    &clk_reg_name="No CBCR"
    &clk_name="gcc_oxili_qdss_at_clk"
    &clk_reg_cbcr_type="cgc"

    gosub Print_Clk_Info_Line
  )
  
  &match=0
  &wild_head=0
  &wild_tail=0
  &clk_input_length=STRING.LENGTH("&clk")
  &clk_itr_length=STRING.LENGTH("gcc_oxili_qdss_tsctr_div8_clk")

  if (STRING.SCAN("&clk", "*", 0)==0)
  (
    &wild_head=1
  )
  if (STRING.SCAN("&clk", "*", 1)==(STRING.LENGTH("&clk")-1))
  (
    &wild_tail=1
  )

  if ((&wild_head==1)&&(&wild_tail==1))
  (
    if (STRING.SCAN("gcc_oxili_qdss_tsctr_div8_clk", STRING.MID("&clk", 1, &clk_input_length-2), 0)!=-1)
    ( 
      &match=1
    )
  )
  else if (&wild_head==1)
  (
    if (STRING.MID("gcc_oxili_qdss_tsctr_div8_clk", &clk_itr_length-&clk_input_length+1, &clk_input_length-1)==STRING.CUT("&clk", 1))
    ( 
      &match=1
    )
  )
  else if (&wild_tail==1)
  (
    if (STRING.MID("gcc_oxili_qdss_tsctr_div8_clk", 0, &clk_input_length-1)==STRING.CUT("&clk", -1))
    ( 
      &match=1
    )
  )	  
  else if ("gcc_oxili_qdss_tsctr_div8_clk"=="&clk")
  (
    &match=1
  )
  
  if (&match==1)
  (
    &clk_test=&CLK_TEST_GCC_OXILI_QDSS_TSCTR_DIV8_CLK
    &clk_reg=0
    &clk_reg_name="No CBCR"
    &clk_name="gcc_oxili_qdss_tsctr_div8_clk"
    &clk_reg_cbcr_type="cgc"

    gosub Print_Clk_Info_Line
  )
  
  &match=0
  &wild_head=0
  &wild_tail=0
  &clk_input_length=STRING.LENGTH("&clk")
  &clk_itr_length=STRING.LENGTH("gcc_pcnoc_ahb_clk")

  if (STRING.SCAN("&clk", "*", 0)==0)
  (
    &wild_head=1
  )
  if (STRING.SCAN("&clk", "*", 1)==(STRING.LENGTH("&clk")-1))
  (
    &wild_tail=1
  )

  if ((&wild_head==1)&&(&wild_tail==1))
  (
    if (STRING.SCAN("gcc_pcnoc_ahb_clk", STRING.MID("&clk", 1, &clk_input_length-2), 0)!=-1)
    ( 
      &match=1
    )
  )
  else if (&wild_head==1)
  (
    if (STRING.MID("gcc_pcnoc_ahb_clk", &clk_itr_length-&clk_input_length+1, &clk_input_length-1)==STRING.CUT("&clk", 1))
    ( 
      &match=1
    )
  )
  else if (&wild_tail==1)
  (
    if (STRING.MID("gcc_pcnoc_ahb_clk", 0, &clk_input_length-1)==STRING.CUT("&clk", -1))
    ( 
      &match=1
    )
  )	  
  else if ("gcc_pcnoc_ahb_clk"=="&clk")
  (
    &match=1
  )
  
  ; This clock belongs to the 'buses' display group.
  if ("buses"=="&clk")
  (
    &match=1	  
  )
  
  if (&match==1)
  (
    &clk_test=&CLK_TEST_GCC_PCNOC_AHB_CLK
    &clk_reg=&HWIO_GCC_PCNOC_AHB_CBCR_ADDR
    &clk_reg_name="GCC_PCNOC_AHB_CBCR"
    &clk_name="gcc_pcnoc_ahb_clk"
    &clk_reg_cbcr_type="sm_cbc"

    gosub Print_Clk_Info_Line
  )
  
  &match=0
  &wild_head=0
  &wild_tail=0
  &clk_input_length=STRING.LENGTH("&clk")
  &clk_itr_length=STRING.LENGTH("gcc_pcnoc_at_clk")

  if (STRING.SCAN("&clk", "*", 0)==0)
  (
    &wild_head=1
  )
  if (STRING.SCAN("&clk", "*", 1)==(STRING.LENGTH("&clk")-1))
  (
    &wild_tail=1
  )

  if ((&wild_head==1)&&(&wild_tail==1))
  (
    if (STRING.SCAN("gcc_pcnoc_at_clk", STRING.MID("&clk", 1, &clk_input_length-2), 0)!=-1)
    ( 
      &match=1
    )
  )
  else if (&wild_head==1)
  (
    if (STRING.MID("gcc_pcnoc_at_clk", &clk_itr_length-&clk_input_length+1, &clk_input_length-1)==STRING.CUT("&clk", 1))
    ( 
      &match=1
    )
  )
  else if (&wild_tail==1)
  (
    if (STRING.MID("gcc_pcnoc_at_clk", 0, &clk_input_length-1)==STRING.CUT("&clk", -1))
    ( 
      &match=1
    )
  )	  
  else if ("gcc_pcnoc_at_clk"=="&clk")
  (
    &match=1
  )
  
  if (&match==1)
  (
    &clk_test=&CLK_TEST_GCC_PCNOC_AT_CLK
    &clk_reg=&HWIO_GCC_PCNOC_AT_CBCR_ADDR
    &clk_reg_name="GCC_PCNOC_AT_CBCR"
    &clk_name="gcc_pcnoc_at_clk"
    &clk_reg_cbcr_type="sm_cbc"

    gosub Print_Clk_Info_Line
  )
  
  &match=0
  &wild_head=0
  &wild_tail=0
  &clk_input_length=STRING.LENGTH("&clk")
  &clk_itr_length=STRING.LENGTH("gcc_pcnoc_rpm_ahb_clk")

  if (STRING.SCAN("&clk", "*", 0)==0)
  (
    &wild_head=1
  )
  if (STRING.SCAN("&clk", "*", 1)==(STRING.LENGTH("&clk")-1))
  (
    &wild_tail=1
  )

  if ((&wild_head==1)&&(&wild_tail==1))
  (
    if (STRING.SCAN("gcc_pcnoc_rpm_ahb_clk", STRING.MID("&clk", 1, &clk_input_length-2), 0)!=-1)
    ( 
      &match=1
    )
  )
  else if (&wild_head==1)
  (
    if (STRING.MID("gcc_pcnoc_rpm_ahb_clk", &clk_itr_length-&clk_input_length+1, &clk_input_length-1)==STRING.CUT("&clk", 1))
    ( 
      &match=1
    )
  )
  else if (&wild_tail==1)
  (
    if (STRING.MID("gcc_pcnoc_rpm_ahb_clk", 0, &clk_input_length-1)==STRING.CUT("&clk", -1))
    ( 
      &match=1
    )
  )	  
  else if ("gcc_pcnoc_rpm_ahb_clk"=="&clk")
  (
    &match=1
  )
  
  if (&match==1)
  (
    &clk_test=&CLK_TEST_GCC_PCNOC_RPM_AHB_CLK
    &clk_reg=&HWIO_GCC_PCNOC_RPM_AHB_CBCR_ADDR
    &clk_reg_name="GCC_PCNOC_RPM_AHB_CBCR"
    &clk_name="gcc_pcnoc_rpm_ahb_clk"
    &clk_reg_cbcr_type="sm_cbc"

    gosub Print_Clk_Info_Line
  )
  
  &match=0
  &wild_head=0
  &wild_tail=0
  &clk_input_length=STRING.LENGTH("&clk")
  &clk_itr_length=STRING.LENGTH("gcc_pcnoc_tic_clk")

  if (STRING.SCAN("&clk", "*", 0)==0)
  (
    &wild_head=1
  )
  if (STRING.SCAN("&clk", "*", 1)==(STRING.LENGTH("&clk")-1))
  (
    &wild_tail=1
  )

  if ((&wild_head==1)&&(&wild_tail==1))
  (
    if (STRING.SCAN("gcc_pcnoc_tic_clk", STRING.MID("&clk", 1, &clk_input_length-2), 0)!=-1)
    ( 
      &match=1
    )
  )
  else if (&wild_head==1)
  (
    if (STRING.MID("gcc_pcnoc_tic_clk", &clk_itr_length-&clk_input_length+1, &clk_input_length-1)==STRING.CUT("&clk", 1))
    ( 
      &match=1
    )
  )
  else if (&wild_tail==1)
  (
    if (STRING.MID("gcc_pcnoc_tic_clk", 0, &clk_input_length-1)==STRING.CUT("&clk", -1))
    ( 
      &match=1
    )
  )	  
  else if ("gcc_pcnoc_tic_clk"=="&clk")
  (
    &match=1
  )
  
  if (&match==1)
  (
    &clk_test=&CLK_TEST_GCC_PCNOC_TIC_CLK
    &clk_reg=0
    &clk_reg_name="No CBCR"
    &clk_name="gcc_pcnoc_tic_clk"
    &clk_reg_cbcr_type="sm_cbc"

    gosub Print_Clk_Info_Line
  )
  
  &match=0
  &wild_head=0
  &wild_tail=0
  &clk_input_length=STRING.LENGTH("&clk")
  &clk_itr_length=STRING.LENGTH("gcc_pcnoc_bus_timeout0_ahb_clk")

  if (STRING.SCAN("&clk", "*", 0)==0)
  (
    &wild_head=1
  )
  if (STRING.SCAN("&clk", "*", 1)==(STRING.LENGTH("&clk")-1))
  (
    &wild_tail=1
  )

  if ((&wild_head==1)&&(&wild_tail==1))
  (
    if (STRING.SCAN("gcc_pcnoc_bus_timeout0_ahb_clk", STRING.MID("&clk", 1, &clk_input_length-2), 0)!=-1)
    ( 
      &match=1
    )
  )
  else if (&wild_head==1)
  (
    if (STRING.MID("gcc_pcnoc_bus_timeout0_ahb_clk", &clk_itr_length-&clk_input_length+1, &clk_input_length-1)==STRING.CUT("&clk", 1))
    ( 
      &match=1
    )
  )
  else if (&wild_tail==1)
  (
    if (STRING.MID("gcc_pcnoc_bus_timeout0_ahb_clk", 0, &clk_input_length-1)==STRING.CUT("&clk", -1))
    ( 
      &match=1
    )
  )	  
  else if ("gcc_pcnoc_bus_timeout0_ahb_clk"=="&clk")
  (
    &match=1
  )
  
  if (&match==1)
  (
    &clk_test=&CLK_TEST_GCC_PCNOC_BUS_TIMEOUT0_AHB_CLK
    &clk_reg=&HWIO_GCC_PCNOC_BUS_TIMEOUT0_AHB_CBCR_ADDR
    &clk_reg_name="GCC_PCNOC_BUS_TIMEOUT0_AHB_CBCR"
    &clk_name="gcc_pcnoc_bus_timeout0_ahb_clk"
    &clk_reg_cbcr_type="sm_cbc"

    gosub Print_Clk_Info_Line
  )
  
  &match=0
  &wild_head=0
  &wild_tail=0
  &clk_input_length=STRING.LENGTH("&clk")
  &clk_itr_length=STRING.LENGTH("gcc_pcnoc_bus_timeout1_ahb_clk")

  if (STRING.SCAN("&clk", "*", 0)==0)
  (
    &wild_head=1
  )
  if (STRING.SCAN("&clk", "*", 1)==(STRING.LENGTH("&clk")-1))
  (
    &wild_tail=1
  )

  if ((&wild_head==1)&&(&wild_tail==1))
  (
    if (STRING.SCAN("gcc_pcnoc_bus_timeout1_ahb_clk", STRING.MID("&clk", 1, &clk_input_length-2), 0)!=-1)
    ( 
      &match=1
    )
  )
  else if (&wild_head==1)
  (
    if (STRING.MID("gcc_pcnoc_bus_timeout1_ahb_clk", &clk_itr_length-&clk_input_length+1, &clk_input_length-1)==STRING.CUT("&clk", 1))
    ( 
      &match=1
    )
  )
  else if (&wild_tail==1)
  (
    if (STRING.MID("gcc_pcnoc_bus_timeout1_ahb_clk", 0, &clk_input_length-1)==STRING.CUT("&clk", -1))
    ( 
      &match=1
    )
  )	  
  else if ("gcc_pcnoc_bus_timeout1_ahb_clk"=="&clk")
  (
    &match=1
  )
  
  if (&match==1)
  (
    &clk_test=&CLK_TEST_GCC_PCNOC_BUS_TIMEOUT1_AHB_CLK
    &clk_reg=&HWIO_GCC_PCNOC_BUS_TIMEOUT1_AHB_CBCR_ADDR
    &clk_reg_name="GCC_PCNOC_BUS_TIMEOUT1_AHB_CBCR"
    &clk_name="gcc_pcnoc_bus_timeout1_ahb_clk"
    &clk_reg_cbcr_type="sm_cbc"

    gosub Print_Clk_Info_Line
  )
  
  &match=0
  &wild_head=0
  &wild_tail=0
  &clk_input_length=STRING.LENGTH("&clk")
  &clk_itr_length=STRING.LENGTH("gcc_pcnoc_bus_timeout2_ahb_clk")

  if (STRING.SCAN("&clk", "*", 0)==0)
  (
    &wild_head=1
  )
  if (STRING.SCAN("&clk", "*", 1)==(STRING.LENGTH("&clk")-1))
  (
    &wild_tail=1
  )

  if ((&wild_head==1)&&(&wild_tail==1))
  (
    if (STRING.SCAN("gcc_pcnoc_bus_timeout2_ahb_clk", STRING.MID("&clk", 1, &clk_input_length-2), 0)!=-1)
    ( 
      &match=1
    )
  )
  else if (&wild_head==1)
  (
    if (STRING.MID("gcc_pcnoc_bus_timeout2_ahb_clk", &clk_itr_length-&clk_input_length+1, &clk_input_length-1)==STRING.CUT("&clk", 1))
    ( 
      &match=1
    )
  )
  else if (&wild_tail==1)
  (
    if (STRING.MID("gcc_pcnoc_bus_timeout2_ahb_clk", 0, &clk_input_length-1)==STRING.CUT("&clk", -1))
    ( 
      &match=1
    )
  )	  
  else if ("gcc_pcnoc_bus_timeout2_ahb_clk"=="&clk")
  (
    &match=1
  )
  
  if (&match==1)
  (
    &clk_test=&CLK_TEST_GCC_PCNOC_BUS_TIMEOUT2_AHB_CLK
    &clk_reg=&HWIO_GCC_PCNOC_BUS_TIMEOUT2_AHB_CBCR_ADDR
    &clk_reg_name="GCC_PCNOC_BUS_TIMEOUT2_AHB_CBCR"
    &clk_name="gcc_pcnoc_bus_timeout2_ahb_clk"
    &clk_reg_cbcr_type="sm_cbc"

    gosub Print_Clk_Info_Line
  )
  
  &match=0
  &wild_head=0
  &wild_tail=0
  &clk_input_length=STRING.LENGTH("&clk")
  &clk_itr_length=STRING.LENGTH("gcc_pcnoc_bus_timeout3_ahb_clk")

  if (STRING.SCAN("&clk", "*", 0)==0)
  (
    &wild_head=1
  )
  if (STRING.SCAN("&clk", "*", 1)==(STRING.LENGTH("&clk")-1))
  (
    &wild_tail=1
  )

  if ((&wild_head==1)&&(&wild_tail==1))
  (
    if (STRING.SCAN("gcc_pcnoc_bus_timeout3_ahb_clk", STRING.MID("&clk", 1, &clk_input_length-2), 0)!=-1)
    ( 
      &match=1
    )
  )
  else if (&wild_head==1)
  (
    if (STRING.MID("gcc_pcnoc_bus_timeout3_ahb_clk", &clk_itr_length-&clk_input_length+1, &clk_input_length-1)==STRING.CUT("&clk", 1))
    ( 
      &match=1
    )
  )
  else if (&wild_tail==1)
  (
    if (STRING.MID("gcc_pcnoc_bus_timeout3_ahb_clk", 0, &clk_input_length-1)==STRING.CUT("&clk", -1))
    ( 
      &match=1
    )
  )	  
  else if ("gcc_pcnoc_bus_timeout3_ahb_clk"=="&clk")
  (
    &match=1
  )
  
  if (&match==1)
  (
    &clk_test=&CLK_TEST_GCC_PCNOC_BUS_TIMEOUT3_AHB_CLK
    &clk_reg=&HWIO_GCC_PCNOC_BUS_TIMEOUT3_AHB_CBCR_ADDR
    &clk_reg_name="GCC_PCNOC_BUS_TIMEOUT3_AHB_CBCR"
    &clk_name="gcc_pcnoc_bus_timeout3_ahb_clk"
    &clk_reg_cbcr_type="sm_cbc"

    gosub Print_Clk_Info_Line
  )
  
  &match=0
  &wild_head=0
  &wild_tail=0
  &clk_input_length=STRING.LENGTH("&clk")
  &clk_itr_length=STRING.LENGTH("gcc_pcnoc_bus_timeout4_ahb_clk")

  if (STRING.SCAN("&clk", "*", 0)==0)
  (
    &wild_head=1
  )
  if (STRING.SCAN("&clk", "*", 1)==(STRING.LENGTH("&clk")-1))
  (
    &wild_tail=1
  )

  if ((&wild_head==1)&&(&wild_tail==1))
  (
    if (STRING.SCAN("gcc_pcnoc_bus_timeout4_ahb_clk", STRING.MID("&clk", 1, &clk_input_length-2), 0)!=-1)
    ( 
      &match=1
    )
  )
  else if (&wild_head==1)
  (
    if (STRING.MID("gcc_pcnoc_bus_timeout4_ahb_clk", &clk_itr_length-&clk_input_length+1, &clk_input_length-1)==STRING.CUT("&clk", 1))
    ( 
      &match=1
    )
  )
  else if (&wild_tail==1)
  (
    if (STRING.MID("gcc_pcnoc_bus_timeout4_ahb_clk", 0, &clk_input_length-1)==STRING.CUT("&clk", -1))
    ( 
      &match=1
    )
  )	  
  else if ("gcc_pcnoc_bus_timeout4_ahb_clk"=="&clk")
  (
    &match=1
  )
  
  if (&match==1)
  (
    &clk_test=&CLK_TEST_GCC_PCNOC_BUS_TIMEOUT4_AHB_CLK
    &clk_reg=&HWIO_GCC_PCNOC_BUS_TIMEOUT4_AHB_CBCR_ADDR
    &clk_reg_name="GCC_PCNOC_BUS_TIMEOUT4_AHB_CBCR"
    &clk_name="gcc_pcnoc_bus_timeout4_ahb_clk"
    &clk_reg_cbcr_type="sm_cbc"

    gosub Print_Clk_Info_Line
  )
  
  &match=0
  &wild_head=0
  &wild_tail=0
  &clk_input_length=STRING.LENGTH("&clk")
  &clk_itr_length=STRING.LENGTH("gcc_pcnoc_bus_timeout5_ahb_clk")

  if (STRING.SCAN("&clk", "*", 0)==0)
  (
    &wild_head=1
  )
  if (STRING.SCAN("&clk", "*", 1)==(STRING.LENGTH("&clk")-1))
  (
    &wild_tail=1
  )

  if ((&wild_head==1)&&(&wild_tail==1))
  (
    if (STRING.SCAN("gcc_pcnoc_bus_timeout5_ahb_clk", STRING.MID("&clk", 1, &clk_input_length-2), 0)!=-1)
    ( 
      &match=1
    )
  )
  else if (&wild_head==1)
  (
    if (STRING.MID("gcc_pcnoc_bus_timeout5_ahb_clk", &clk_itr_length-&clk_input_length+1, &clk_input_length-1)==STRING.CUT("&clk", 1))
    ( 
      &match=1
    )
  )
  else if (&wild_tail==1)
  (
    if (STRING.MID("gcc_pcnoc_bus_timeout5_ahb_clk", 0, &clk_input_length-1)==STRING.CUT("&clk", -1))
    ( 
      &match=1
    )
  )	  
  else if ("gcc_pcnoc_bus_timeout5_ahb_clk"=="&clk")
  (
    &match=1
  )
  
  if (&match==1)
  (
    &clk_test=&CLK_TEST_GCC_PCNOC_BUS_TIMEOUT5_AHB_CLK
    &clk_reg=&HWIO_GCC_PCNOC_BUS_TIMEOUT5_AHB_CBCR_ADDR
    &clk_reg_name="GCC_PCNOC_BUS_TIMEOUT5_AHB_CBCR"
    &clk_name="gcc_pcnoc_bus_timeout5_ahb_clk"
    &clk_reg_cbcr_type="sm_cbc"

    gosub Print_Clk_Info_Line
  )
  
  &match=0
  &wild_head=0
  &wild_tail=0
  &clk_input_length=STRING.LENGTH("&clk")
  &clk_itr_length=STRING.LENGTH("gcc_pcnoc_bus_timeout6_ahb_clk")

  if (STRING.SCAN("&clk", "*", 0)==0)
  (
    &wild_head=1
  )
  if (STRING.SCAN("&clk", "*", 1)==(STRING.LENGTH("&clk")-1))
  (
    &wild_tail=1
  )

  if ((&wild_head==1)&&(&wild_tail==1))
  (
    if (STRING.SCAN("gcc_pcnoc_bus_timeout6_ahb_clk", STRING.MID("&clk", 1, &clk_input_length-2), 0)!=-1)
    ( 
      &match=1
    )
  )
  else if (&wild_head==1)
  (
    if (STRING.MID("gcc_pcnoc_bus_timeout6_ahb_clk", &clk_itr_length-&clk_input_length+1, &clk_input_length-1)==STRING.CUT("&clk", 1))
    ( 
      &match=1
    )
  )
  else if (&wild_tail==1)
  (
    if (STRING.MID("gcc_pcnoc_bus_timeout6_ahb_clk", 0, &clk_input_length-1)==STRING.CUT("&clk", -1))
    ( 
      &match=1
    )
  )	  
  else if ("gcc_pcnoc_bus_timeout6_ahb_clk"=="&clk")
  (
    &match=1
  )
  
  if (&match==1)
  (
    &clk_test=&CLK_TEST_GCC_PCNOC_BUS_TIMEOUT6_AHB_CLK
    &clk_reg=&HWIO_GCC_PCNOC_BUS_TIMEOUT6_AHB_CBCR_ADDR
    &clk_reg_name="GCC_PCNOC_BUS_TIMEOUT6_AHB_CBCR"
    &clk_name="gcc_pcnoc_bus_timeout6_ahb_clk"
    &clk_reg_cbcr_type="sm_cbc"

    gosub Print_Clk_Info_Line
  )
  
  &match=0
  &wild_head=0
  &wild_tail=0
  &clk_input_length=STRING.LENGTH("&clk")
  &clk_itr_length=STRING.LENGTH("gcc_pcnoc_bus_timeout7_ahb_clk")

  if (STRING.SCAN("&clk", "*", 0)==0)
  (
    &wild_head=1
  )
  if (STRING.SCAN("&clk", "*", 1)==(STRING.LENGTH("&clk")-1))
  (
    &wild_tail=1
  )

  if ((&wild_head==1)&&(&wild_tail==1))
  (
    if (STRING.SCAN("gcc_pcnoc_bus_timeout7_ahb_clk", STRING.MID("&clk", 1, &clk_input_length-2), 0)!=-1)
    ( 
      &match=1
    )
  )
  else if (&wild_head==1)
  (
    if (STRING.MID("gcc_pcnoc_bus_timeout7_ahb_clk", &clk_itr_length-&clk_input_length+1, &clk_input_length-1)==STRING.CUT("&clk", 1))
    ( 
      &match=1
    )
  )
  else if (&wild_tail==1)
  (
    if (STRING.MID("gcc_pcnoc_bus_timeout7_ahb_clk", 0, &clk_input_length-1)==STRING.CUT("&clk", -1))
    ( 
      &match=1
    )
  )	  
  else if ("gcc_pcnoc_bus_timeout7_ahb_clk"=="&clk")
  (
    &match=1
  )
  
  if (&match==1)
  (
    &clk_test=&CLK_TEST_GCC_PCNOC_BUS_TIMEOUT7_AHB_CLK
    &clk_reg=&HWIO_GCC_PCNOC_BUS_TIMEOUT7_AHB_CBCR_ADDR
    &clk_reg_name="GCC_PCNOC_BUS_TIMEOUT7_AHB_CBCR"
    &clk_name="gcc_pcnoc_bus_timeout7_ahb_clk"
    &clk_reg_cbcr_type="sm_cbc"

    gosub Print_Clk_Info_Line
  )
  
  &match=0
  &wild_head=0
  &wild_tail=0
  &clk_input_length=STRING.LENGTH("&clk")
  &clk_itr_length=STRING.LENGTH("gcc_pcnoc_bus_timeout8_ahb_clk")

  if (STRING.SCAN("&clk", "*", 0)==0)
  (
    &wild_head=1
  )
  if (STRING.SCAN("&clk", "*", 1)==(STRING.LENGTH("&clk")-1))
  (
    &wild_tail=1
  )

  if ((&wild_head==1)&&(&wild_tail==1))
  (
    if (STRING.SCAN("gcc_pcnoc_bus_timeout8_ahb_clk", STRING.MID("&clk", 1, &clk_input_length-2), 0)!=-1)
    ( 
      &match=1
    )
  )
  else if (&wild_head==1)
  (
    if (STRING.MID("gcc_pcnoc_bus_timeout8_ahb_clk", &clk_itr_length-&clk_input_length+1, &clk_input_length-1)==STRING.CUT("&clk", 1))
    ( 
      &match=1
    )
  )
  else if (&wild_tail==1)
  (
    if (STRING.MID("gcc_pcnoc_bus_timeout8_ahb_clk", 0, &clk_input_length-1)==STRING.CUT("&clk", -1))
    ( 
      &match=1
    )
  )	  
  else if ("gcc_pcnoc_bus_timeout8_ahb_clk"=="&clk")
  (
    &match=1
  )
  
  if (&match==1)
  (
    &clk_test=&CLK_TEST_GCC_PCNOC_BUS_TIMEOUT8_AHB_CLK
    &clk_reg=&HWIO_GCC_PCNOC_BUS_TIMEOUT8_AHB_CBCR_ADDR
    &clk_reg_name="GCC_PCNOC_BUS_TIMEOUT8_AHB_CBCR"
    &clk_name="gcc_pcnoc_bus_timeout8_ahb_clk"
    &clk_reg_cbcr_type="sm_cbc"

    gosub Print_Clk_Info_Line
  )
  
  &match=0
  &wild_head=0
  &wild_tail=0
  &clk_input_length=STRING.LENGTH("&clk")
  &clk_itr_length=STRING.LENGTH("gcc_pcnoc_bus_timeout9_ahb_clk")

  if (STRING.SCAN("&clk", "*", 0)==0)
  (
    &wild_head=1
  )
  if (STRING.SCAN("&clk", "*", 1)==(STRING.LENGTH("&clk")-1))
  (
    &wild_tail=1
  )

  if ((&wild_head==1)&&(&wild_tail==1))
  (
    if (STRING.SCAN("gcc_pcnoc_bus_timeout9_ahb_clk", STRING.MID("&clk", 1, &clk_input_length-2), 0)!=-1)
    ( 
      &match=1
    )
  )
  else if (&wild_head==1)
  (
    if (STRING.MID("gcc_pcnoc_bus_timeout9_ahb_clk", &clk_itr_length-&clk_input_length+1, &clk_input_length-1)==STRING.CUT("&clk", 1))
    ( 
      &match=1
    )
  )
  else if (&wild_tail==1)
  (
    if (STRING.MID("gcc_pcnoc_bus_timeout9_ahb_clk", 0, &clk_input_length-1)==STRING.CUT("&clk", -1))
    ( 
      &match=1
    )
  )	  
  else if ("gcc_pcnoc_bus_timeout9_ahb_clk"=="&clk")
  (
    &match=1
  )
  
  if (&match==1)
  (
    &clk_test=&CLK_TEST_GCC_PCNOC_BUS_TIMEOUT9_AHB_CLK
    &clk_reg=&HWIO_GCC_PCNOC_BUS_TIMEOUT9_AHB_CBCR_ADDR
    &clk_reg_name="GCC_PCNOC_BUS_TIMEOUT9_AHB_CBCR"
    &clk_name="gcc_pcnoc_bus_timeout9_ahb_clk"
    &clk_reg_cbcr_type="sm_cbc"

    gosub Print_Clk_Info_Line
  )
  
  &match=0
  &wild_head=0
  &wild_tail=0
  &clk_input_length=STRING.LENGTH("&clk")
  &clk_itr_length=STRING.LENGTH("gcc_pdm2_clk")

  if (STRING.SCAN("&clk", "*", 0)==0)
  (
    &wild_head=1
  )
  if (STRING.SCAN("&clk", "*", 1)==(STRING.LENGTH("&clk")-1))
  (
    &wild_tail=1
  )

  if ((&wild_head==1)&&(&wild_tail==1))
  (
    if (STRING.SCAN("gcc_pdm2_clk", STRING.MID("&clk", 1, &clk_input_length-2), 0)!=-1)
    ( 
      &match=1
    )
  )
  else if (&wild_head==1)
  (
    if (STRING.MID("gcc_pdm2_clk", &clk_itr_length-&clk_input_length+1, &clk_input_length-1)==STRING.CUT("&clk", 1))
    ( 
      &match=1
    )
  )
  else if (&wild_tail==1)
  (
    if (STRING.MID("gcc_pdm2_clk", 0, &clk_input_length-1)==STRING.CUT("&clk", -1))
    ( 
      &match=1
    )
  )	  
  else if ("gcc_pdm2_clk"=="&clk")
  (
    &match=1
  )
  
  if (&match==1)
  (
    &clk_test=&CLK_TEST_GCC_PDM2_CLK
    &clk_reg=&HWIO_GCC_PDM2_CBCR_ADDR
    &clk_reg_name="GCC_PDM2_CBCR"
    &clk_name="gcc_pdm2_clk"
    &clk_reg_cbcr_type="sm_cbc"

    gosub Print_Clk_Info_Line
  )
  
  &match=0
  &wild_head=0
  &wild_tail=0
  &clk_input_length=STRING.LENGTH("&clk")
  &clk_itr_length=STRING.LENGTH("gcc_pdm_ahb_clk")

  if (STRING.SCAN("&clk", "*", 0)==0)
  (
    &wild_head=1
  )
  if (STRING.SCAN("&clk", "*", 1)==(STRING.LENGTH("&clk")-1))
  (
    &wild_tail=1
  )

  if ((&wild_head==1)&&(&wild_tail==1))
  (
    if (STRING.SCAN("gcc_pdm_ahb_clk", STRING.MID("&clk", 1, &clk_input_length-2), 0)!=-1)
    ( 
      &match=1
    )
  )
  else if (&wild_head==1)
  (
    if (STRING.MID("gcc_pdm_ahb_clk", &clk_itr_length-&clk_input_length+1, &clk_input_length-1)==STRING.CUT("&clk", 1))
    ( 
      &match=1
    )
  )
  else if (&wild_tail==1)
  (
    if (STRING.MID("gcc_pdm_ahb_clk", 0, &clk_input_length-1)==STRING.CUT("&clk", -1))
    ( 
      &match=1
    )
  )	  
  else if ("gcc_pdm_ahb_clk"=="&clk")
  (
    &match=1
  )
  
  if (&match==1)
  (
    &clk_test=&CLK_TEST_GCC_PDM_AHB_CLK
    &clk_reg=&HWIO_GCC_PDM_AHB_CBCR_ADDR
    &clk_reg_name="GCC_PDM_AHB_CBCR"
    &clk_name="gcc_pdm_ahb_clk"
    &clk_reg_cbcr_type="sm_cbc"

    gosub Print_Clk_Info_Line
  )
  
  &match=0
  &wild_head=0
  &wild_tail=0
  &clk_input_length=STRING.LENGTH("&clk")
  &clk_itr_length=STRING.LENGTH("gcc_pdm_xo4_clk")

  if (STRING.SCAN("&clk", "*", 0)==0)
  (
    &wild_head=1
  )
  if (STRING.SCAN("&clk", "*", 1)==(STRING.LENGTH("&clk")-1))
  (
    &wild_tail=1
  )

  if ((&wild_head==1)&&(&wild_tail==1))
  (
    if (STRING.SCAN("gcc_pdm_xo4_clk", STRING.MID("&clk", 1, &clk_input_length-2), 0)!=-1)
    ( 
      &match=1
    )
  )
  else if (&wild_head==1)
  (
    if (STRING.MID("gcc_pdm_xo4_clk", &clk_itr_length-&clk_input_length+1, &clk_input_length-1)==STRING.CUT("&clk", 1))
    ( 
      &match=1
    )
  )
  else if (&wild_tail==1)
  (
    if (STRING.MID("gcc_pdm_xo4_clk", 0, &clk_input_length-1)==STRING.CUT("&clk", -1))
    ( 
      &match=1
    )
  )	  
  else if ("gcc_pdm_xo4_clk"=="&clk")
  (
    &match=1
  )
  
  if (&match==1)
  (
    &clk_test=&CLK_TEST_GCC_PDM_XO4_CLK
    &clk_reg=&HWIO_GCC_PDM_XO4_CBCR_ADDR
    &clk_reg_name="GCC_PDM_XO4_CBCR"
    &clk_name="gcc_pdm_xo4_clk"
    &clk_reg_cbcr_type="sm_cbc"

    gosub Print_Clk_Info_Line
  )
  
  &match=0
  &wild_head=0
  &wild_tail=0
  &clk_input_length=STRING.LENGTH("&clk")
  &clk_itr_length=STRING.LENGTH("gcc_prng_ahb_clk")

  if (STRING.SCAN("&clk", "*", 0)==0)
  (
    &wild_head=1
  )
  if (STRING.SCAN("&clk", "*", 1)==(STRING.LENGTH("&clk")-1))
  (
    &wild_tail=1
  )

  if ((&wild_head==1)&&(&wild_tail==1))
  (
    if (STRING.SCAN("gcc_prng_ahb_clk", STRING.MID("&clk", 1, &clk_input_length-2), 0)!=-1)
    ( 
      &match=1
    )
  )
  else if (&wild_head==1)
  (
    if (STRING.MID("gcc_prng_ahb_clk", &clk_itr_length-&clk_input_length+1, &clk_input_length-1)==STRING.CUT("&clk", 1))
    ( 
      &match=1
    )
  )
  else if (&wild_tail==1)
  (
    if (STRING.MID("gcc_prng_ahb_clk", 0, &clk_input_length-1)==STRING.CUT("&clk", -1))
    ( 
      &match=1
    )
  )	  
  else if ("gcc_prng_ahb_clk"=="&clk")
  (
    &match=1
  )
  
  if (&match==1)
  (
    &clk_test=&CLK_TEST_GCC_PRNG_AHB_CLK
    &clk_reg=&HWIO_GCC_PRNG_AHB_CBCR_ADDR
    &clk_reg_name="GCC_PRNG_AHB_CBCR"
    &clk_name="gcc_prng_ahb_clk"
    &clk_reg_cbcr_type="sm_cbc"

    gosub Print_Clk_Info_Line
  )
  
  &match=0
  &wild_head=0
  &wild_tail=0
  &clk_input_length=STRING.LENGTH("&clk")
  &clk_itr_length=STRING.LENGTH("gcc_qdss_at_clk")

  if (STRING.SCAN("&clk", "*", 0)==0)
  (
    &wild_head=1
  )
  if (STRING.SCAN("&clk", "*", 1)==(STRING.LENGTH("&clk")-1))
  (
    &wild_tail=1
  )

  if ((&wild_head==1)&&(&wild_tail==1))
  (
    if (STRING.SCAN("gcc_qdss_at_clk", STRING.MID("&clk", 1, &clk_input_length-2), 0)!=-1)
    ( 
      &match=1
    )
  )
  else if (&wild_head==1)
  (
    if (STRING.MID("gcc_qdss_at_clk", &clk_itr_length-&clk_input_length+1, &clk_input_length-1)==STRING.CUT("&clk", 1))
    ( 
      &match=1
    )
  )
  else if (&wild_tail==1)
  (
    if (STRING.MID("gcc_qdss_at_clk", 0, &clk_input_length-1)==STRING.CUT("&clk", -1))
    ( 
      &match=1
    )
  )	  
  else if ("gcc_qdss_at_clk"=="&clk")
  (
    &match=1
  )
  
  if (&match==1)
  (
    &clk_test=&CLK_TEST_GCC_QDSS_AT_CLK
    &clk_reg=&HWIO_GCC_QDSS_AT_CBCR_ADDR
    &clk_reg_name="GCC_QDSS_AT_CBCR"
    &clk_name="gcc_qdss_at_clk"
    &clk_reg_cbcr_type="sm_pscbc"

    gosub Print_Clk_Info_Line
  )
  
  &match=0
  &wild_head=0
  &wild_tail=0
  &clk_input_length=STRING.LENGTH("&clk")
  &clk_itr_length=STRING.LENGTH("gcc_qdss_cfg_ahb_clk")

  if (STRING.SCAN("&clk", "*", 0)==0)
  (
    &wild_head=1
  )
  if (STRING.SCAN("&clk", "*", 1)==(STRING.LENGTH("&clk")-1))
  (
    &wild_tail=1
  )

  if ((&wild_head==1)&&(&wild_tail==1))
  (
    if (STRING.SCAN("gcc_qdss_cfg_ahb_clk", STRING.MID("&clk", 1, &clk_input_length-2), 0)!=-1)
    ( 
      &match=1
    )
  )
  else if (&wild_head==1)
  (
    if (STRING.MID("gcc_qdss_cfg_ahb_clk", &clk_itr_length-&clk_input_length+1, &clk_input_length-1)==STRING.CUT("&clk", 1))
    ( 
      &match=1
    )
  )
  else if (&wild_tail==1)
  (
    if (STRING.MID("gcc_qdss_cfg_ahb_clk", 0, &clk_input_length-1)==STRING.CUT("&clk", -1))
    ( 
      &match=1
    )
  )	  
  else if ("gcc_qdss_cfg_ahb_clk"=="&clk")
  (
    &match=1
  )
  
  if (&match==1)
  (
    &clk_test=&CLK_TEST_GCC_QDSS_CFG_AHB_CLK
    &clk_reg=&HWIO_GCC_QDSS_CFG_AHB_CBCR_ADDR
    &clk_reg_name="GCC_QDSS_CFG_AHB_CBCR"
    &clk_name="gcc_qdss_cfg_ahb_clk"
    &clk_reg_cbcr_type="sm_cbc"

    gosub Print_Clk_Info_Line
  )
  
  &match=0
  &wild_head=0
  &wild_tail=0
  &clk_input_length=STRING.LENGTH("&clk")
  &clk_itr_length=STRING.LENGTH("gcc_qdss_dap_ahb_clk")

  if (STRING.SCAN("&clk", "*", 0)==0)
  (
    &wild_head=1
  )
  if (STRING.SCAN("&clk", "*", 1)==(STRING.LENGTH("&clk")-1))
  (
    &wild_tail=1
  )

  if ((&wild_head==1)&&(&wild_tail==1))
  (
    if (STRING.SCAN("gcc_qdss_dap_ahb_clk", STRING.MID("&clk", 1, &clk_input_length-2), 0)!=-1)
    ( 
      &match=1
    )
  )
  else if (&wild_head==1)
  (
    if (STRING.MID("gcc_qdss_dap_ahb_clk", &clk_itr_length-&clk_input_length+1, &clk_input_length-1)==STRING.CUT("&clk", 1))
    ( 
      &match=1
    )
  )
  else if (&wild_tail==1)
  (
    if (STRING.MID("gcc_qdss_dap_ahb_clk", 0, &clk_input_length-1)==STRING.CUT("&clk", -1))
    ( 
      &match=1
    )
  )	  
  else if ("gcc_qdss_dap_ahb_clk"=="&clk")
  (
    &match=1
  )
  
  if (&match==1)
  (
    &clk_test=&CLK_TEST_GCC_QDSS_DAP_AHB_CLK
    &clk_reg=&HWIO_GCC_QDSS_DAP_AHB_CBCR_ADDR
    &clk_reg_name="GCC_QDSS_DAP_AHB_CBCR"
    &clk_name="gcc_qdss_dap_ahb_clk"
    &clk_reg_cbcr_type="sm_cbc"

    gosub Print_Clk_Info_Line
  )
  
  &match=0
  &wild_head=0
  &wild_tail=0
  &clk_input_length=STRING.LENGTH("&clk")
  &clk_itr_length=STRING.LENGTH("gcc_qdss_dap_clk")

  if (STRING.SCAN("&clk", "*", 0)==0)
  (
    &wild_head=1
  )
  if (STRING.SCAN("&clk", "*", 1)==(STRING.LENGTH("&clk")-1))
  (
    &wild_tail=1
  )

  if ((&wild_head==1)&&(&wild_tail==1))
  (
    if (STRING.SCAN("gcc_qdss_dap_clk", STRING.MID("&clk", 1, &clk_input_length-2), 0)!=-1)
    ( 
      &match=1
    )
  )
  else if (&wild_head==1)
  (
    if (STRING.MID("gcc_qdss_dap_clk", &clk_itr_length-&clk_input_length+1, &clk_input_length-1)==STRING.CUT("&clk", 1))
    ( 
      &match=1
    )
  )
  else if (&wild_tail==1)
  (
    if (STRING.MID("gcc_qdss_dap_clk", 0, &clk_input_length-1)==STRING.CUT("&clk", -1))
    ( 
      &match=1
    )
  )	  
  else if ("gcc_qdss_dap_clk"=="&clk")
  (
    &match=1
  )
  
  if (&match==1)
  (
    &clk_test=&CLK_TEST_GCC_QDSS_DAP_CLK
    &clk_reg=&HWIO_GCC_QDSS_DAP_CBCR_ADDR
    &clk_reg_name="GCC_QDSS_DAP_CBCR"
    &clk_name="gcc_qdss_dap_clk"
    &clk_reg_cbcr_type="sm_cbc"

    gosub Print_Clk_Info_Line
  )
  
  &match=0
  &wild_head=0
  &wild_tail=0
  &clk_input_length=STRING.LENGTH("&clk")
  &clk_itr_length=STRING.LENGTH("gcc_qdss_etr_usb_clk")

  if (STRING.SCAN("&clk", "*", 0)==0)
  (
    &wild_head=1
  )
  if (STRING.SCAN("&clk", "*", 1)==(STRING.LENGTH("&clk")-1))
  (
    &wild_tail=1
  )

  if ((&wild_head==1)&&(&wild_tail==1))
  (
    if (STRING.SCAN("gcc_qdss_etr_usb_clk", STRING.MID("&clk", 1, &clk_input_length-2), 0)!=-1)
    ( 
      &match=1
    )
  )
  else if (&wild_head==1)
  (
    if (STRING.MID("gcc_qdss_etr_usb_clk", &clk_itr_length-&clk_input_length+1, &clk_input_length-1)==STRING.CUT("&clk", 1))
    ( 
      &match=1
    )
  )
  else if (&wild_tail==1)
  (
    if (STRING.MID("gcc_qdss_etr_usb_clk", 0, &clk_input_length-1)==STRING.CUT("&clk", -1))
    ( 
      &match=1
    )
  )	  
  else if ("gcc_qdss_etr_usb_clk"=="&clk")
  (
    &match=1
  )
  
  if (&match==1)
  (
    &clk_test=&CLK_TEST_GCC_QDSS_ETR_USB_CLK
    &clk_reg=&HWIO_GCC_QDSS_ETR_USB_CBCR_ADDR
    &clk_reg_name="GCC_QDSS_ETR_USB_CBCR"
    &clk_name="gcc_qdss_etr_usb_clk"
    &clk_reg_cbcr_type="sm_cbc"

    gosub Print_Clk_Info_Line
  )
  
  &match=0
  &wild_head=0
  &wild_tail=0
  &clk_input_length=STRING.LENGTH("&clk")
  &clk_itr_length=STRING.LENGTH("gcc_qdss_stm_clk")

  if (STRING.SCAN("&clk", "*", 0)==0)
  (
    &wild_head=1
  )
  if (STRING.SCAN("&clk", "*", 1)==(STRING.LENGTH("&clk")-1))
  (
    &wild_tail=1
  )

  if ((&wild_head==1)&&(&wild_tail==1))
  (
    if (STRING.SCAN("gcc_qdss_stm_clk", STRING.MID("&clk", 1, &clk_input_length-2), 0)!=-1)
    ( 
      &match=1
    )
  )
  else if (&wild_head==1)
  (
    if (STRING.MID("gcc_qdss_stm_clk", &clk_itr_length-&clk_input_length+1, &clk_input_length-1)==STRING.CUT("&clk", 1))
    ( 
      &match=1
    )
  )
  else if (&wild_tail==1)
  (
    if (STRING.MID("gcc_qdss_stm_clk", 0, &clk_input_length-1)==STRING.CUT("&clk", -1))
    ( 
      &match=1
    )
  )	  
  else if ("gcc_qdss_stm_clk"=="&clk")
  (
    &match=1
  )
  
  if (&match==1)
  (
    &clk_test=&CLK_TEST_GCC_QDSS_STM_CLK
    &clk_reg=&HWIO_GCC_QDSS_STM_CBCR_ADDR
    &clk_reg_name="GCC_QDSS_STM_CBCR"
    &clk_name="gcc_qdss_stm_clk"
    &clk_reg_cbcr_type="sm_cbc"

    gosub Print_Clk_Info_Line
  )
  
  &match=0
  &wild_head=0
  &wild_tail=0
  &clk_input_length=STRING.LENGTH("&clk")
  &clk_itr_length=STRING.LENGTH("gcc_qdss_traceclkin_clk")

  if (STRING.SCAN("&clk", "*", 0)==0)
  (
    &wild_head=1
  )
  if (STRING.SCAN("&clk", "*", 1)==(STRING.LENGTH("&clk")-1))
  (
    &wild_tail=1
  )

  if ((&wild_head==1)&&(&wild_tail==1))
  (
    if (STRING.SCAN("gcc_qdss_traceclkin_clk", STRING.MID("&clk", 1, &clk_input_length-2), 0)!=-1)
    ( 
      &match=1
    )
  )
  else if (&wild_head==1)
  (
    if (STRING.MID("gcc_qdss_traceclkin_clk", &clk_itr_length-&clk_input_length+1, &clk_input_length-1)==STRING.CUT("&clk", 1))
    ( 
      &match=1
    )
  )
  else if (&wild_tail==1)
  (
    if (STRING.MID("gcc_qdss_traceclkin_clk", 0, &clk_input_length-1)==STRING.CUT("&clk", -1))
    ( 
      &match=1
    )
  )	  
  else if ("gcc_qdss_traceclkin_clk"=="&clk")
  (
    &match=1
  )
  
  if (&match==1)
  (
    &clk_test=&CLK_TEST_GCC_QDSS_TRACECLKIN_CLK
    &clk_reg=&HWIO_GCC_QDSS_TRACECLKIN_CBCR_ADDR
    &clk_reg_name="GCC_QDSS_TRACECLKIN_CBCR"
    &clk_name="gcc_qdss_traceclkin_clk"
    &clk_reg_cbcr_type="sm_cbc"

    gosub Print_Clk_Info_Line
  )
  
  &match=0
  &wild_head=0
  &wild_tail=0
  &clk_input_length=STRING.LENGTH("&clk")
  &clk_itr_length=STRING.LENGTH("gcc_qdss_tsctr_div16_clk")

  if (STRING.SCAN("&clk", "*", 0)==0)
  (
    &wild_head=1
  )
  if (STRING.SCAN("&clk", "*", 1)==(STRING.LENGTH("&clk")-1))
  (
    &wild_tail=1
  )

  if ((&wild_head==1)&&(&wild_tail==1))
  (
    if (STRING.SCAN("gcc_qdss_tsctr_div16_clk", STRING.MID("&clk", 1, &clk_input_length-2), 0)!=-1)
    ( 
      &match=1
    )
  )
  else if (&wild_head==1)
  (
    if (STRING.MID("gcc_qdss_tsctr_div16_clk", &clk_itr_length-&clk_input_length+1, &clk_input_length-1)==STRING.CUT("&clk", 1))
    ( 
      &match=1
    )
  )
  else if (&wild_tail==1)
  (
    if (STRING.MID("gcc_qdss_tsctr_div16_clk", 0, &clk_input_length-1)==STRING.CUT("&clk", -1))
    ( 
      &match=1
    )
  )	  
  else if ("gcc_qdss_tsctr_div16_clk"=="&clk")
  (
    &match=1
  )
  
  if (&match==1)
  (
    &clk_test=&CLK_TEST_GCC_QDSS_TSCTR_DIV16_CLK
    &clk_reg=&HWIO_GCC_QDSS_TSCTR_DIV16_CBCR_ADDR
    &clk_reg_name="GCC_QDSS_TSCTR_DIV16_CBCR"
    &clk_name="gcc_qdss_tsctr_div16_clk"
    &clk_reg_cbcr_type="sm_cbc"

    gosub Print_Clk_Info_Line
  )
  
  &match=0
  &wild_head=0
  &wild_tail=0
  &clk_input_length=STRING.LENGTH("&clk")
  &clk_itr_length=STRING.LENGTH("gcc_qdss_tsctr_div2_clk")

  if (STRING.SCAN("&clk", "*", 0)==0)
  (
    &wild_head=1
  )
  if (STRING.SCAN("&clk", "*", 1)==(STRING.LENGTH("&clk")-1))
  (
    &wild_tail=1
  )

  if ((&wild_head==1)&&(&wild_tail==1))
  (
    if (STRING.SCAN("gcc_qdss_tsctr_div2_clk", STRING.MID("&clk", 1, &clk_input_length-2), 0)!=-1)
    ( 
      &match=1
    )
  )
  else if (&wild_head==1)
  (
    if (STRING.MID("gcc_qdss_tsctr_div2_clk", &clk_itr_length-&clk_input_length+1, &clk_input_length-1)==STRING.CUT("&clk", 1))
    ( 
      &match=1
    )
  )
  else if (&wild_tail==1)
  (
    if (STRING.MID("gcc_qdss_tsctr_div2_clk", 0, &clk_input_length-1)==STRING.CUT("&clk", -1))
    ( 
      &match=1
    )
  )	  
  else if ("gcc_qdss_tsctr_div2_clk"=="&clk")
  (
    &match=1
  )
  
  if (&match==1)
  (
    &clk_test=&CLK_TEST_GCC_QDSS_TSCTR_DIV2_CLK
    &clk_reg=&HWIO_GCC_QDSS_TSCTR_DIV2_CBCR_ADDR
    &clk_reg_name="GCC_QDSS_TSCTR_DIV2_CBCR"
    &clk_name="gcc_qdss_tsctr_div2_clk"
    &clk_reg_cbcr_type="sm_cbc"

    gosub Print_Clk_Info_Line
  )
  
  &match=0
  &wild_head=0
  &wild_tail=0
  &clk_input_length=STRING.LENGTH("&clk")
  &clk_itr_length=STRING.LENGTH("gcc_qdss_tsctr_div3_clk")

  if (STRING.SCAN("&clk", "*", 0)==0)
  (
    &wild_head=1
  )
  if (STRING.SCAN("&clk", "*", 1)==(STRING.LENGTH("&clk")-1))
  (
    &wild_tail=1
  )

  if ((&wild_head==1)&&(&wild_tail==1))
  (
    if (STRING.SCAN("gcc_qdss_tsctr_div3_clk", STRING.MID("&clk", 1, &clk_input_length-2), 0)!=-1)
    ( 
      &match=1
    )
  )
  else if (&wild_head==1)
  (
    if (STRING.MID("gcc_qdss_tsctr_div3_clk", &clk_itr_length-&clk_input_length+1, &clk_input_length-1)==STRING.CUT("&clk", 1))
    ( 
      &match=1
    )
  )
  else if (&wild_tail==1)
  (
    if (STRING.MID("gcc_qdss_tsctr_div3_clk", 0, &clk_input_length-1)==STRING.CUT("&clk", -1))
    ( 
      &match=1
    )
  )	  
  else if ("gcc_qdss_tsctr_div3_clk"=="&clk")
  (
    &match=1
  )
  
  if (&match==1)
  (
    &clk_test=&CLK_TEST_GCC_QDSS_TSCTR_DIV3_CLK
    &clk_reg=&HWIO_GCC_QDSS_TSCTR_DIV3_CBCR_ADDR
    &clk_reg_name="GCC_QDSS_TSCTR_DIV3_CBCR"
    &clk_name="gcc_qdss_tsctr_div3_clk"
    &clk_reg_cbcr_type="sm_cbc"

    gosub Print_Clk_Info_Line
  )
  
  &match=0
  &wild_head=0
  &wild_tail=0
  &clk_input_length=STRING.LENGTH("&clk")
  &clk_itr_length=STRING.LENGTH("gcc_qdss_tsctr_div4_clk")

  if (STRING.SCAN("&clk", "*", 0)==0)
  (
    &wild_head=1
  )
  if (STRING.SCAN("&clk", "*", 1)==(STRING.LENGTH("&clk")-1))
  (
    &wild_tail=1
  )

  if ((&wild_head==1)&&(&wild_tail==1))
  (
    if (STRING.SCAN("gcc_qdss_tsctr_div4_clk", STRING.MID("&clk", 1, &clk_input_length-2), 0)!=-1)
    ( 
      &match=1
    )
  )
  else if (&wild_head==1)
  (
    if (STRING.MID("gcc_qdss_tsctr_div4_clk", &clk_itr_length-&clk_input_length+1, &clk_input_length-1)==STRING.CUT("&clk", 1))
    ( 
      &match=1
    )
  )
  else if (&wild_tail==1)
  (
    if (STRING.MID("gcc_qdss_tsctr_div4_clk", 0, &clk_input_length-1)==STRING.CUT("&clk", -1))
    ( 
      &match=1
    )
  )	  
  else if ("gcc_qdss_tsctr_div4_clk"=="&clk")
  (
    &match=1
  )
  
  if (&match==1)
  (
    &clk_test=&CLK_TEST_GCC_QDSS_TSCTR_DIV4_CLK
    &clk_reg=&HWIO_GCC_QDSS_TSCTR_DIV4_CBCR_ADDR
    &clk_reg_name="GCC_QDSS_TSCTR_DIV4_CBCR"
    &clk_name="gcc_qdss_tsctr_div4_clk"
    &clk_reg_cbcr_type="sm_cbc"

    gosub Print_Clk_Info_Line
  )
  
  &match=0
  &wild_head=0
  &wild_tail=0
  &clk_input_length=STRING.LENGTH("&clk")
  &clk_itr_length=STRING.LENGTH("gcc_qdss_tsctr_div8_clk")

  if (STRING.SCAN("&clk", "*", 0)==0)
  (
    &wild_head=1
  )
  if (STRING.SCAN("&clk", "*", 1)==(STRING.LENGTH("&clk")-1))
  (
    &wild_tail=1
  )

  if ((&wild_head==1)&&(&wild_tail==1))
  (
    if (STRING.SCAN("gcc_qdss_tsctr_div8_clk", STRING.MID("&clk", 1, &clk_input_length-2), 0)!=-1)
    ( 
      &match=1
    )
  )
  else if (&wild_head==1)
  (
    if (STRING.MID("gcc_qdss_tsctr_div8_clk", &clk_itr_length-&clk_input_length+1, &clk_input_length-1)==STRING.CUT("&clk", 1))
    ( 
      &match=1
    )
  )
  else if (&wild_tail==1)
  (
    if (STRING.MID("gcc_qdss_tsctr_div8_clk", 0, &clk_input_length-1)==STRING.CUT("&clk", -1))
    ( 
      &match=1
    )
  )	  
  else if ("gcc_qdss_tsctr_div8_clk"=="&clk")
  (
    &match=1
  )
  
  if (&match==1)
  (
    &clk_test=&CLK_TEST_GCC_QDSS_TSCTR_DIV8_CLK
    &clk_reg=&HWIO_GCC_QDSS_TSCTR_DIV8_CBCR_ADDR
    &clk_reg_name="GCC_QDSS_TSCTR_DIV8_CBCR"
    &clk_name="gcc_qdss_tsctr_div8_clk"
    &clk_reg_cbcr_type="sm_cbc"

    gosub Print_Clk_Info_Line
  )
  
  &match=0
  &wild_head=0
  &wild_tail=0
  &clk_input_length=STRING.LENGTH("&clk")
  &clk_itr_length=STRING.LENGTH("gcc_qpic_ahb_clk")

  if (STRING.SCAN("&clk", "*", 0)==0)
  (
    &wild_head=1
  )
  if (STRING.SCAN("&clk", "*", 1)==(STRING.LENGTH("&clk")-1))
  (
    &wild_tail=1
  )

  if ((&wild_head==1)&&(&wild_tail==1))
  (
    if (STRING.SCAN("gcc_qpic_ahb_clk", STRING.MID("&clk", 1, &clk_input_length-2), 0)!=-1)
    ( 
      &match=1
    )
  )
  else if (&wild_head==1)
  (
    if (STRING.MID("gcc_qpic_ahb_clk", &clk_itr_length-&clk_input_length+1, &clk_input_length-1)==STRING.CUT("&clk", 1))
    ( 
      &match=1
    )
  )
  else if (&wild_tail==1)
  (
    if (STRING.MID("gcc_qpic_ahb_clk", 0, &clk_input_length-1)==STRING.CUT("&clk", -1))
    ( 
      &match=1
    )
  )	  
  else if ("gcc_qpic_ahb_clk"=="&clk")
  (
    &match=1
  )
  
  if (&match==1)
  (
    &clk_test=&CLK_TEST_GCC_QPIC_AHB_CLK
    &clk_reg=&HWIO_GCC_QPIC_AHB_CBCR_ADDR
    &clk_reg_name="GCC_QPIC_AHB_CBCR"
    &clk_name="gcc_qpic_ahb_clk"
    &clk_reg_cbcr_type="sm_pscbc"

    gosub Print_Clk_Info_Line
  )
  
  &match=0
  &wild_head=0
  &wild_tail=0
  &clk_input_length=STRING.LENGTH("&clk")
  &clk_itr_length=STRING.LENGTH("gcc_qpic_clk")

  if (STRING.SCAN("&clk", "*", 0)==0)
  (
    &wild_head=1
  )
  if (STRING.SCAN("&clk", "*", 1)==(STRING.LENGTH("&clk")-1))
  (
    &wild_tail=1
  )

  if ((&wild_head==1)&&(&wild_tail==1))
  (
    if (STRING.SCAN("gcc_qpic_clk", STRING.MID("&clk", 1, &clk_input_length-2), 0)!=-1)
    ( 
      &match=1
    )
  )
  else if (&wild_head==1)
  (
    if (STRING.MID("gcc_qpic_clk", &clk_itr_length-&clk_input_length+1, &clk_input_length-1)==STRING.CUT("&clk", 1))
    ( 
      &match=1
    )
  )
  else if (&wild_tail==1)
  (
    if (STRING.MID("gcc_qpic_clk", 0, &clk_input_length-1)==STRING.CUT("&clk", -1))
    ( 
      &match=1
    )
  )	  
  else if ("gcc_qpic_clk"=="&clk")
  (
    &match=1
  )
  
  if (&match==1)
  (
    &clk_test=&CLK_TEST_GCC_QPIC_CLK
    &clk_reg=&HWIO_GCC_QPIC_CBCR_ADDR
    &clk_reg_name="GCC_QPIC_CBCR"
    &clk_name="gcc_qpic_clk"
    &clk_reg_cbcr_type="sm_pscbc"

    gosub Print_Clk_Info_Line
  )
  
  &match=0
  &wild_head=0
  &wild_tail=0
  &clk_input_length=STRING.LENGTH("&clk")
  &clk_itr_length=STRING.LENGTH("gcc_qpic_system_clk")

  if (STRING.SCAN("&clk", "*", 0)==0)
  (
    &wild_head=1
  )
  if (STRING.SCAN("&clk", "*", 1)==(STRING.LENGTH("&clk")-1))
  (
    &wild_tail=1
  )

  if ((&wild_head==1)&&(&wild_tail==1))
  (
    if (STRING.SCAN("gcc_qpic_system_clk", STRING.MID("&clk", 1, &clk_input_length-2), 0)!=-1)
    ( 
      &match=1
    )
  )
  else if (&wild_head==1)
  (
    if (STRING.MID("gcc_qpic_system_clk", &clk_itr_length-&clk_input_length+1, &clk_input_length-1)==STRING.CUT("&clk", 1))
    ( 
      &match=1
    )
  )
  else if (&wild_tail==1)
  (
    if (STRING.MID("gcc_qpic_system_clk", 0, &clk_input_length-1)==STRING.CUT("&clk", -1))
    ( 
      &match=1
    )
  )	  
  else if ("gcc_qpic_system_clk"=="&clk")
  (
    &match=1
  )
  
  if (&match==1)
  (
    &clk_test=&CLK_TEST_GCC_QPIC_SYSTEM_CLK
    &clk_reg=&HWIO_GCC_QPIC_SYSTEM_CBCR_ADDR
    &clk_reg_name="GCC_QPIC_SYSTEM_CBCR"
    &clk_name="gcc_qpic_system_clk"
    &clk_reg_cbcr_type="sm_cbc"

    gosub Print_Clk_Info_Line
  )
  
  &match=0
  &wild_head=0
  &wild_tail=0
  &clk_input_length=STRING.LENGTH("&clk")
  &clk_itr_length=STRING.LENGTH("gcc_rbcpr_ahb_clk")

  if (STRING.SCAN("&clk", "*", 0)==0)
  (
    &wild_head=1
  )
  if (STRING.SCAN("&clk", "*", 1)==(STRING.LENGTH("&clk")-1))
  (
    &wild_tail=1
  )

  if ((&wild_head==1)&&(&wild_tail==1))
  (
    if (STRING.SCAN("gcc_rbcpr_ahb_clk", STRING.MID("&clk", 1, &clk_input_length-2), 0)!=-1)
    ( 
      &match=1
    )
  )
  else if (&wild_head==1)
  (
    if (STRING.MID("gcc_rbcpr_ahb_clk", &clk_itr_length-&clk_input_length+1, &clk_input_length-1)==STRING.CUT("&clk", 1))
    ( 
      &match=1
    )
  )
  else if (&wild_tail==1)
  (
    if (STRING.MID("gcc_rbcpr_ahb_clk", 0, &clk_input_length-1)==STRING.CUT("&clk", -1))
    ( 
      &match=1
    )
  )	  
  else if ("gcc_rbcpr_ahb_clk"=="&clk")
  (
    &match=1
  )
  
  if (&match==1)
  (
    &clk_test=&CLK_TEST_GCC_RBCPR_AHB_CLK
    &clk_reg=&HWIO_GCC_RBCPR_AHB_CBCR_ADDR
    &clk_reg_name="GCC_RBCPR_AHB_CBCR"
    &clk_name="gcc_rbcpr_ahb_clk"
    &clk_reg_cbcr_type="sm_cbc"

    gosub Print_Clk_Info_Line
  )
  
  &match=0
  &wild_head=0
  &wild_tail=0
  &clk_input_length=STRING.LENGTH("&clk")
  &clk_itr_length=STRING.LENGTH("gcc_rbcpr_clk")

  if (STRING.SCAN("&clk", "*", 0)==0)
  (
    &wild_head=1
  )
  if (STRING.SCAN("&clk", "*", 1)==(STRING.LENGTH("&clk")-1))
  (
    &wild_tail=1
  )

  if ((&wild_head==1)&&(&wild_tail==1))
  (
    if (STRING.SCAN("gcc_rbcpr_clk", STRING.MID("&clk", 1, &clk_input_length-2), 0)!=-1)
    ( 
      &match=1
    )
  )
  else if (&wild_head==1)
  (
    if (STRING.MID("gcc_rbcpr_clk", &clk_itr_length-&clk_input_length+1, &clk_input_length-1)==STRING.CUT("&clk", 1))
    ( 
      &match=1
    )
  )
  else if (&wild_tail==1)
  (
    if (STRING.MID("gcc_rbcpr_clk", 0, &clk_input_length-1)==STRING.CUT("&clk", -1))
    ( 
      &match=1
    )
  )	  
  else if ("gcc_rbcpr_clk"=="&clk")
  (
    &match=1
  )
  
  if (&match==1)
  (
    &clk_test=&CLK_TEST_GCC_RBCPR_CLK
    &clk_reg=&HWIO_GCC_RBCPR_CBCR_ADDR
    &clk_reg_name="GCC_RBCPR_CBCR"
    &clk_name="gcc_rbcpr_clk"
    &clk_reg_cbcr_type="sm_cbc"

    gosub Print_Clk_Info_Line
  )
  
  &match=0
  &wild_head=0
  &wild_tail=0
  &clk_input_length=STRING.LENGTH("&clk")
  &clk_itr_length=STRING.LENGTH("gcc_rpm_bus_ahb_clk")

  if (STRING.SCAN("&clk", "*", 0)==0)
  (
    &wild_head=1
  )
  if (STRING.SCAN("&clk", "*", 1)==(STRING.LENGTH("&clk")-1))
  (
    &wild_tail=1
  )

  if ((&wild_head==1)&&(&wild_tail==1))
  (
    if (STRING.SCAN("gcc_rpm_bus_ahb_clk", STRING.MID("&clk", 1, &clk_input_length-2), 0)!=-1)
    ( 
      &match=1
    )
  )
  else if (&wild_head==1)
  (
    if (STRING.MID("gcc_rpm_bus_ahb_clk", &clk_itr_length-&clk_input_length+1, &clk_input_length-1)==STRING.CUT("&clk", 1))
    ( 
      &match=1
    )
  )
  else if (&wild_tail==1)
  (
    if (STRING.MID("gcc_rpm_bus_ahb_clk", 0, &clk_input_length-1)==STRING.CUT("&clk", -1))
    ( 
      &match=1
    )
  )	  
  else if ("gcc_rpm_bus_ahb_clk"=="&clk")
  (
    &match=1
  )
  
  if (&match==1)
  (
    &clk_test=&CLK_TEST_GCC_RPM_BUS_AHB_CLK
    &clk_reg=&HWIO_GCC_RPM_BUS_AHB_CBCR_ADDR
    &clk_reg_name="GCC_RPM_BUS_AHB_CBCR"
    &clk_name="gcc_rpm_bus_ahb_clk"
    &clk_reg_cbcr_type="sm_pscbc"

    gosub Print_Clk_Info_Line
  )
  
  &match=0
  &wild_head=0
  &wild_tail=0
  &clk_input_length=STRING.LENGTH("&clk")
  &clk_itr_length=STRING.LENGTH("gcc_rpm_proc_fclk")

  if (STRING.SCAN("&clk", "*", 0)==0)
  (
    &wild_head=1
  )
  if (STRING.SCAN("&clk", "*", 1)==(STRING.LENGTH("&clk")-1))
  (
    &wild_tail=1
  )

  if ((&wild_head==1)&&(&wild_tail==1))
  (
    if (STRING.SCAN("gcc_rpm_proc_fclk", STRING.MID("&clk", 1, &clk_input_length-2), 0)!=-1)
    ( 
      &match=1
    )
  )
  else if (&wild_head==1)
  (
    if (STRING.MID("gcc_rpm_proc_fclk", &clk_itr_length-&clk_input_length+1, &clk_input_length-1)==STRING.CUT("&clk", 1))
    ( 
      &match=1
    )
  )
  else if (&wild_tail==1)
  (
    if (STRING.MID("gcc_rpm_proc_fclk", 0, &clk_input_length-1)==STRING.CUT("&clk", -1))
    ( 
      &match=1
    )
  )	  
  else if ("gcc_rpm_proc_fclk"=="&clk")
  (
    &match=1
  )
  
  ; This clock belongs to the 'cpus' display group.
  if ("cpus"=="&clk")
  (
    &match=1	  
  )
  
  if (&match==1)
  (
    &clk_test=&CLK_TEST_GCC_RPM_PROC_FCLK
    &clk_reg=0
    &clk_reg_name="No CBCR"
    &clk_name="gcc_rpm_proc_fclk"
    &clk_reg_cbcr_type="sm_cbc"

    gosub Print_Clk_Info_Line
  )
  
  &match=0
  &wild_head=0
  &wild_tail=0
  &clk_input_length=STRING.LENGTH("&clk")
  &clk_itr_length=STRING.LENGTH("gcc_rpm_proc_hclk")

  if (STRING.SCAN("&clk", "*", 0)==0)
  (
    &wild_head=1
  )
  if (STRING.SCAN("&clk", "*", 1)==(STRING.LENGTH("&clk")-1))
  (
    &wild_tail=1
  )

  if ((&wild_head==1)&&(&wild_tail==1))
  (
    if (STRING.SCAN("gcc_rpm_proc_hclk", STRING.MID("&clk", 1, &clk_input_length-2), 0)!=-1)
    ( 
      &match=1
    )
  )
  else if (&wild_head==1)
  (
    if (STRING.MID("gcc_rpm_proc_hclk", &clk_itr_length-&clk_input_length+1, &clk_input_length-1)==STRING.CUT("&clk", 1))
    ( 
      &match=1
    )
  )
  else if (&wild_tail==1)
  (
    if (STRING.MID("gcc_rpm_proc_hclk", 0, &clk_input_length-1)==STRING.CUT("&clk", -1))
    ( 
      &match=1
    )
  )	  
  else if ("gcc_rpm_proc_hclk"=="&clk")
  (
    &match=1
  )
  
  if (&match==1)
  (
    &clk_test=&CLK_TEST_GCC_RPM_PROC_HCLK
    &clk_reg=&HWIO_GCC_RPM_PROC_HCLK_CBCR_ADDR
    &clk_reg_name="GCC_RPM_PROC_HCLK_CBCR"
    &clk_name="gcc_rpm_proc_hclk"
    &clk_reg_cbcr_type="sm_cbc"

    gosub Print_Clk_Info_Line
  )
  
  &match=0
  &wild_head=0
  &wild_tail=0
  &clk_input_length=STRING.LENGTH("&clk")
  &clk_itr_length=STRING.LENGTH("gcc_rpm_sleep_clk")

  if (STRING.SCAN("&clk", "*", 0)==0)
  (
    &wild_head=1
  )
  if (STRING.SCAN("&clk", "*", 1)==(STRING.LENGTH("&clk")-1))
  (
    &wild_tail=1
  )

  if ((&wild_head==1)&&(&wild_tail==1))
  (
    if (STRING.SCAN("gcc_rpm_sleep_clk", STRING.MID("&clk", 1, &clk_input_length-2), 0)!=-1)
    ( 
      &match=1
    )
  )
  else if (&wild_head==1)
  (
    if (STRING.MID("gcc_rpm_sleep_clk", &clk_itr_length-&clk_input_length+1, &clk_input_length-1)==STRING.CUT("&clk", 1))
    ( 
      &match=1
    )
  )
  else if (&wild_tail==1)
  (
    if (STRING.MID("gcc_rpm_sleep_clk", 0, &clk_input_length-1)==STRING.CUT("&clk", -1))
    ( 
      &match=1
    )
  )	  
  else if ("gcc_rpm_sleep_clk"=="&clk")
  (
    &match=1
  )
  
  if (&match==1)
  (
    &clk_test=&CLK_TEST_GCC_RPM_SLEEP_CLK
    &clk_reg=&HWIO_GCC_RPM_SLEEP_CBCR_ADDR
    &clk_reg_name="GCC_RPM_SLEEP_CBCR"
    &clk_name="gcc_rpm_sleep_clk"
    &clk_reg_cbcr_type="sm_cbc"

    gosub Print_Clk_Info_Line
  )
  
  &match=0
  &wild_head=0
  &wild_tail=0
  &clk_input_length=STRING.LENGTH("&clk")
  &clk_itr_length=STRING.LENGTH("gcc_rpm_timer_clk")

  if (STRING.SCAN("&clk", "*", 0)==0)
  (
    &wild_head=1
  )
  if (STRING.SCAN("&clk", "*", 1)==(STRING.LENGTH("&clk")-1))
  (
    &wild_tail=1
  )

  if ((&wild_head==1)&&(&wild_tail==1))
  (
    if (STRING.SCAN("gcc_rpm_timer_clk", STRING.MID("&clk", 1, &clk_input_length-2), 0)!=-1)
    ( 
      &match=1
    )
  )
  else if (&wild_head==1)
  (
    if (STRING.MID("gcc_rpm_timer_clk", &clk_itr_length-&clk_input_length+1, &clk_input_length-1)==STRING.CUT("&clk", 1))
    ( 
      &match=1
    )
  )
  else if (&wild_tail==1)
  (
    if (STRING.MID("gcc_rpm_timer_clk", 0, &clk_input_length-1)==STRING.CUT("&clk", -1))
    ( 
      &match=1
    )
  )	  
  else if ("gcc_rpm_timer_clk"=="&clk")
  (
    &match=1
  )
  
  if (&match==1)
  (
    &clk_test=&CLK_TEST_GCC_RPM_TIMER_CLK
    &clk_reg=&HWIO_GCC_RPM_TIMER_CBCR_ADDR
    &clk_reg_name="GCC_RPM_TIMER_CBCR"
    &clk_name="gcc_rpm_timer_clk"
    &clk_reg_cbcr_type="sm_cbc"

    gosub Print_Clk_Info_Line
  )
  
  &match=0
  &wild_head=0
  &wild_tail=0
  &clk_input_length=STRING.LENGTH("&clk")
  &clk_itr_length=STRING.LENGTH("gcc_rpm_cfg_xpu_clk")

  if (STRING.SCAN("&clk", "*", 0)==0)
  (
    &wild_head=1
  )
  if (STRING.SCAN("&clk", "*", 1)==(STRING.LENGTH("&clk")-1))
  (
    &wild_tail=1
  )

  if ((&wild_head==1)&&(&wild_tail==1))
  (
    if (STRING.SCAN("gcc_rpm_cfg_xpu_clk", STRING.MID("&clk", 1, &clk_input_length-2), 0)!=-1)
    ( 
      &match=1
    )
  )
  else if (&wild_head==1)
  (
    if (STRING.MID("gcc_rpm_cfg_xpu_clk", &clk_itr_length-&clk_input_length+1, &clk_input_length-1)==STRING.CUT("&clk", 1))
    ( 
      &match=1
    )
  )
  else if (&wild_tail==1)
  (
    if (STRING.MID("gcc_rpm_cfg_xpu_clk", 0, &clk_input_length-1)==STRING.CUT("&clk", -1))
    ( 
      &match=1
    )
  )	  
  else if ("gcc_rpm_cfg_xpu_clk"=="&clk")
  (
    &match=1
  )
  
  if (&match==1)
  (
    &clk_test=&CLK_TEST_GCC_RPM_CFG_XPU_CLK
    &clk_reg=&HWIO_GCC_RPM_CFG_XPU_CBCR_ADDR
    &clk_reg_name="GCC_RPM_CFG_XPU_CBCR"
    &clk_name="gcc_rpm_cfg_xpu_clk"
    &clk_reg_cbcr_type="sm_cbc"

    gosub Print_Clk_Info_Line
  )
  
  &match=0
  &wild_head=0
  &wild_tail=0
  &clk_input_length=STRING.LENGTH("&clk")
  &clk_itr_length=STRING.LENGTH("gcc_sdcc1_ahb_clk")

  if (STRING.SCAN("&clk", "*", 0)==0)
  (
    &wild_head=1
  )
  if (STRING.SCAN("&clk", "*", 1)==(STRING.LENGTH("&clk")-1))
  (
    &wild_tail=1
  )

  if ((&wild_head==1)&&(&wild_tail==1))
  (
    if (STRING.SCAN("gcc_sdcc1_ahb_clk", STRING.MID("&clk", 1, &clk_input_length-2), 0)!=-1)
    ( 
      &match=1
    )
  )
  else if (&wild_head==1)
  (
    if (STRING.MID("gcc_sdcc1_ahb_clk", &clk_itr_length-&clk_input_length+1, &clk_input_length-1)==STRING.CUT("&clk", 1))
    ( 
      &match=1
    )
  )
  else if (&wild_tail==1)
  (
    if (STRING.MID("gcc_sdcc1_ahb_clk", 0, &clk_input_length-1)==STRING.CUT("&clk", -1))
    ( 
      &match=1
    )
  )	  
  else if ("gcc_sdcc1_ahb_clk"=="&clk")
  (
    &match=1
  )
  
  if (&match==1)
  (
    &clk_test=&CLK_TEST_GCC_SDCC1_AHB_CLK
    &clk_reg=&HWIO_GCC_SDCC1_AHB_CBCR_ADDR
    &clk_reg_name="GCC_SDCC1_AHB_CBCR"
    &clk_name="gcc_sdcc1_ahb_clk"
    &clk_reg_cbcr_type="sm_pscbc"

    gosub Print_Clk_Info_Line
  )
  
  &match=0
  &wild_head=0
  &wild_tail=0
  &clk_input_length=STRING.LENGTH("&clk")
  &clk_itr_length=STRING.LENGTH("gcc_sdcc1_apps_clk")

  if (STRING.SCAN("&clk", "*", 0)==0)
  (
    &wild_head=1
  )
  if (STRING.SCAN("&clk", "*", 1)==(STRING.LENGTH("&clk")-1))
  (
    &wild_tail=1
  )

  if ((&wild_head==1)&&(&wild_tail==1))
  (
    if (STRING.SCAN("gcc_sdcc1_apps_clk", STRING.MID("&clk", 1, &clk_input_length-2), 0)!=-1)
    ( 
      &match=1
    )
  )
  else if (&wild_head==1)
  (
    if (STRING.MID("gcc_sdcc1_apps_clk", &clk_itr_length-&clk_input_length+1, &clk_input_length-1)==STRING.CUT("&clk", 1))
    ( 
      &match=1
    )
  )
  else if (&wild_tail==1)
  (
    if (STRING.MID("gcc_sdcc1_apps_clk", 0, &clk_input_length-1)==STRING.CUT("&clk", -1))
    ( 
      &match=1
    )
  )	  
  else if ("gcc_sdcc1_apps_clk"=="&clk")
  (
    &match=1
  )
  
  if (&match==1)
  (
    &clk_test=&CLK_TEST_GCC_SDCC1_APPS_CLK
    &clk_reg=&HWIO_GCC_SDCC1_APPS_CBCR_ADDR
    &clk_reg_name="GCC_SDCC1_APPS_CBCR"
    &clk_name="gcc_sdcc1_apps_clk"
    &clk_reg_cbcr_type="sm_pscbc"

    gosub Print_Clk_Info_Line
  )
  
  &match=0
  &wild_head=0
  &wild_tail=0
  &clk_input_length=STRING.LENGTH("&clk")
  &clk_itr_length=STRING.LENGTH("gcc_sdcc2_ahb_clk")

  if (STRING.SCAN("&clk", "*", 0)==0)
  (
    &wild_head=1
  )
  if (STRING.SCAN("&clk", "*", 1)==(STRING.LENGTH("&clk")-1))
  (
    &wild_tail=1
  )

  if ((&wild_head==1)&&(&wild_tail==1))
  (
    if (STRING.SCAN("gcc_sdcc2_ahb_clk", STRING.MID("&clk", 1, &clk_input_length-2), 0)!=-1)
    ( 
      &match=1
    )
  )
  else if (&wild_head==1)
  (
    if (STRING.MID("gcc_sdcc2_ahb_clk", &clk_itr_length-&clk_input_length+1, &clk_input_length-1)==STRING.CUT("&clk", 1))
    ( 
      &match=1
    )
  )
  else if (&wild_tail==1)
  (
    if (STRING.MID("gcc_sdcc2_ahb_clk", 0, &clk_input_length-1)==STRING.CUT("&clk", -1))
    ( 
      &match=1
    )
  )	  
  else if ("gcc_sdcc2_ahb_clk"=="&clk")
  (
    &match=1
  )
  
  if (&match==1)
  (
    &clk_test=&CLK_TEST_GCC_SDCC2_AHB_CLK
    &clk_reg=&HWIO_GCC_SDCC2_AHB_CBCR_ADDR
    &clk_reg_name="GCC_SDCC2_AHB_CBCR"
    &clk_name="gcc_sdcc2_ahb_clk"
    &clk_reg_cbcr_type="sm_pscbc"

    gosub Print_Clk_Info_Line
  )
  
  &match=0
  &wild_head=0
  &wild_tail=0
  &clk_input_length=STRING.LENGTH("&clk")
  &clk_itr_length=STRING.LENGTH("gcc_sdcc2_apps_clk")

  if (STRING.SCAN("&clk", "*", 0)==0)
  (
    &wild_head=1
  )
  if (STRING.SCAN("&clk", "*", 1)==(STRING.LENGTH("&clk")-1))
  (
    &wild_tail=1
  )

  if ((&wild_head==1)&&(&wild_tail==1))
  (
    if (STRING.SCAN("gcc_sdcc2_apps_clk", STRING.MID("&clk", 1, &clk_input_length-2), 0)!=-1)
    ( 
      &match=1
    )
  )
  else if (&wild_head==1)
  (
    if (STRING.MID("gcc_sdcc2_apps_clk", &clk_itr_length-&clk_input_length+1, &clk_input_length-1)==STRING.CUT("&clk", 1))
    ( 
      &match=1
    )
  )
  else if (&wild_tail==1)
  (
    if (STRING.MID("gcc_sdcc2_apps_clk", 0, &clk_input_length-1)==STRING.CUT("&clk", -1))
    ( 
      &match=1
    )
  )	  
  else if ("gcc_sdcc2_apps_clk"=="&clk")
  (
    &match=1
  )
  
  if (&match==1)
  (
    &clk_test=&CLK_TEST_GCC_SDCC2_APPS_CLK
    &clk_reg=&HWIO_GCC_SDCC2_APPS_CBCR_ADDR
    &clk_reg_name="GCC_SDCC2_APPS_CBCR"
    &clk_name="gcc_sdcc2_apps_clk"
    &clk_reg_cbcr_type="sm_pscbc"

    gosub Print_Clk_Info_Line
  )
  
  &match=0
  &wild_head=0
  &wild_tail=0
  &clk_input_length=STRING.LENGTH("&clk")
  &clk_itr_length=STRING.LENGTH("gcc_apss_tcu_async_clk")

  if (STRING.SCAN("&clk", "*", 0)==0)
  (
    &wild_head=1
  )
  if (STRING.SCAN("&clk", "*", 1)==(STRING.LENGTH("&clk")-1))
  (
    &wild_tail=1
  )

  if ((&wild_head==1)&&(&wild_tail==1))
  (
    if (STRING.SCAN("gcc_apss_tcu_async_clk", STRING.MID("&clk", 1, &clk_input_length-2), 0)!=-1)
    ( 
      &match=1
    )
  )
  else if (&wild_head==1)
  (
    if (STRING.MID("gcc_apss_tcu_async_clk", &clk_itr_length-&clk_input_length+1, &clk_input_length-1)==STRING.CUT("&clk", 1))
    ( 
      &match=1
    )
  )
  else if (&wild_tail==1)
  (
    if (STRING.MID("gcc_apss_tcu_async_clk", 0, &clk_input_length-1)==STRING.CUT("&clk", -1))
    ( 
      &match=1
    )
  )	  
  else if ("gcc_apss_tcu_async_clk"=="&clk")
  (
    &match=1
  )
  
  if (&match==1)
  (
    &clk_test=&CLK_TEST_GCC_APSS_TCU_ASYNC_CLK
    &clk_reg=&HWIO_GCC_APSS_TCU_ASYNC_CBCR_ADDR
    &clk_reg_name="GCC_APSS_TCU_ASYNC_CBCR"
    &clk_name="gcc_apss_tcu_async_clk"
    &clk_reg_cbcr_type="sm_pscbc"

    gosub Print_Clk_Info_Line
  )
  
  &match=0
  &wild_head=0
  &wild_tail=0
  &clk_input_length=STRING.LENGTH("&clk")
  &clk_itr_length=STRING.LENGTH("gcc_apss_tcu_clk")

  if (STRING.SCAN("&clk", "*", 0)==0)
  (
    &wild_head=1
  )
  if (STRING.SCAN("&clk", "*", 1)==(STRING.LENGTH("&clk")-1))
  (
    &wild_tail=1
  )

  if ((&wild_head==1)&&(&wild_tail==1))
  (
    if (STRING.SCAN("gcc_apss_tcu_clk", STRING.MID("&clk", 1, &clk_input_length-2), 0)!=-1)
    ( 
      &match=1
    )
  )
  else if (&wild_head==1)
  (
    if (STRING.MID("gcc_apss_tcu_clk", &clk_itr_length-&clk_input_length+1, &clk_input_length-1)==STRING.CUT("&clk", 1))
    ( 
      &match=1
    )
  )
  else if (&wild_tail==1)
  (
    if (STRING.MID("gcc_apss_tcu_clk", 0, &clk_input_length-1)==STRING.CUT("&clk", -1))
    ( 
      &match=1
    )
  )	  
  else if ("gcc_apss_tcu_clk"=="&clk")
  (
    &match=1
  )
  
  if (&match==1)
  (
    &clk_test=&CLK_TEST_GCC_APSS_TCU_CLK
    &clk_reg=&HWIO_GCC_APSS_TCU_CBCR_ADDR
    &clk_reg_name="GCC_APSS_TCU_CBCR"
    &clk_name="gcc_apss_tcu_clk"
    &clk_reg_cbcr_type="sm_pscbc"

    gosub Print_Clk_Info_Line
  )
  
  &match=0
  &wild_head=0
  &wild_tail=0
  &clk_input_length=STRING.LENGTH("&clk")
  &clk_itr_length=STRING.LENGTH("gcc_gfx_tbu_clk")

  if (STRING.SCAN("&clk", "*", 0)==0)
  (
    &wild_head=1
  )
  if (STRING.SCAN("&clk", "*", 1)==(STRING.LENGTH("&clk")-1))
  (
    &wild_tail=1
  )

  if ((&wild_head==1)&&(&wild_tail==1))
  (
    if (STRING.SCAN("gcc_gfx_tbu_clk", STRING.MID("&clk", 1, &clk_input_length-2), 0)!=-1)
    ( 
      &match=1
    )
  )
  else if (&wild_head==1)
  (
    if (STRING.MID("gcc_gfx_tbu_clk", &clk_itr_length-&clk_input_length+1, &clk_input_length-1)==STRING.CUT("&clk", 1))
    ( 
      &match=1
    )
  )
  else if (&wild_tail==1)
  (
    if (STRING.MID("gcc_gfx_tbu_clk", 0, &clk_input_length-1)==STRING.CUT("&clk", -1))
    ( 
      &match=1
    )
  )	  
  else if ("gcc_gfx_tbu_clk"=="&clk")
  (
    &match=1
  )
  
  if (&match==1)
  (
    &clk_test=&CLK_TEST_GCC_GFX_TBU_CLK
    &clk_reg=&HWIO_GCC_GFX_TBU_CBCR_ADDR
    &clk_reg_name="GCC_GFX_TBU_CBCR"
    &clk_name="gcc_gfx_tbu_clk"
    &clk_reg_cbcr_type="sm_pscbc"

    gosub Print_Clk_Info_Line
  )
  
  &match=0
  &wild_head=0
  &wild_tail=0
  &clk_input_length=STRING.LENGTH("&clk")
  &clk_itr_length=STRING.LENGTH("gcc_gfx_tcu_clk")

  if (STRING.SCAN("&clk", "*", 0)==0)
  (
    &wild_head=1
  )
  if (STRING.SCAN("&clk", "*", 1)==(STRING.LENGTH("&clk")-1))
  (
    &wild_tail=1
  )

  if ((&wild_head==1)&&(&wild_tail==1))
  (
    if (STRING.SCAN("gcc_gfx_tcu_clk", STRING.MID("&clk", 1, &clk_input_length-2), 0)!=-1)
    ( 
      &match=1
    )
  )
  else if (&wild_head==1)
  (
    if (STRING.MID("gcc_gfx_tcu_clk", &clk_itr_length-&clk_input_length+1, &clk_input_length-1)==STRING.CUT("&clk", 1))
    ( 
      &match=1
    )
  )
  else if (&wild_tail==1)
  (
    if (STRING.MID("gcc_gfx_tcu_clk", 0, &clk_input_length-1)==STRING.CUT("&clk", -1))
    ( 
      &match=1
    )
  )	  
  else if ("gcc_gfx_tcu_clk"=="&clk")
  (
    &match=1
  )
  
  if (&match==1)
  (
    &clk_test=&CLK_TEST_GCC_GFX_TCU_CLK
    &clk_reg=&HWIO_GCC_GFX_TCU_CBCR_ADDR
    &clk_reg_name="GCC_GFX_TCU_CBCR"
    &clk_name="gcc_gfx_tcu_clk"
    &clk_reg_cbcr_type="sm_pscbc"

    gosub Print_Clk_Info_Line
  )
  
  &match=0
  &wild_head=0
  &wild_tail=0
  &clk_input_length=STRING.LENGTH("&clk")
  &clk_itr_length=STRING.LENGTH("gcc_gtcu_ahb_clk")

  if (STRING.SCAN("&clk", "*", 0)==0)
  (
    &wild_head=1
  )
  if (STRING.SCAN("&clk", "*", 1)==(STRING.LENGTH("&clk")-1))
  (
    &wild_tail=1
  )

  if ((&wild_head==1)&&(&wild_tail==1))
  (
    if (STRING.SCAN("gcc_gtcu_ahb_clk", STRING.MID("&clk", 1, &clk_input_length-2), 0)!=-1)
    ( 
      &match=1
    )
  )
  else if (&wild_head==1)
  (
    if (STRING.MID("gcc_gtcu_ahb_clk", &clk_itr_length-&clk_input_length+1, &clk_input_length-1)==STRING.CUT("&clk", 1))
    ( 
      &match=1
    )
  )
  else if (&wild_tail==1)
  (
    if (STRING.MID("gcc_gtcu_ahb_clk", 0, &clk_input_length-1)==STRING.CUT("&clk", -1))
    ( 
      &match=1
    )
  )	  
  else if ("gcc_gtcu_ahb_clk"=="&clk")
  (
    &match=1
  )
  
  if (&match==1)
  (
    &clk_test=&CLK_TEST_GCC_GTCU_AHB_CLK
    &clk_reg=&HWIO_GCC_GTCU_AHB_CBCR_ADDR
    &clk_reg_name="GCC_GTCU_AHB_CBCR"
    &clk_name="gcc_gtcu_ahb_clk"
    &clk_reg_cbcr_type="sm_cbc"

    gosub Print_Clk_Info_Line
  )
  
  &match=0
  &wild_head=0
  &wild_tail=0
  &clk_input_length=STRING.LENGTH("&clk")
  &clk_itr_length=STRING.LENGTH("gcc_mdp_tbu_clk")

  if (STRING.SCAN("&clk", "*", 0)==0)
  (
    &wild_head=1
  )
  if (STRING.SCAN("&clk", "*", 1)==(STRING.LENGTH("&clk")-1))
  (
    &wild_tail=1
  )

  if ((&wild_head==1)&&(&wild_tail==1))
  (
    if (STRING.SCAN("gcc_mdp_tbu_clk", STRING.MID("&clk", 1, &clk_input_length-2), 0)!=-1)
    ( 
      &match=1
    )
  )
  else if (&wild_head==1)
  (
    if (STRING.MID("gcc_mdp_tbu_clk", &clk_itr_length-&clk_input_length+1, &clk_input_length-1)==STRING.CUT("&clk", 1))
    ( 
      &match=1
    )
  )
  else if (&wild_tail==1)
  (
    if (STRING.MID("gcc_mdp_tbu_clk", 0, &clk_input_length-1)==STRING.CUT("&clk", -1))
    ( 
      &match=1
    )
  )	  
  else if ("gcc_mdp_tbu_clk"=="&clk")
  (
    &match=1
  )
  
  if (&match==1)
  (
    &clk_test=&CLK_TEST_GCC_MDP_TBU_CLK
    &clk_reg=&HWIO_GCC_MDP_TBU_CBCR_ADDR
    &clk_reg_name="GCC_MDP_TBU_CBCR"
    &clk_name="gcc_mdp_tbu_clk"
    &clk_reg_cbcr_type="sm_pscbc"

    gosub Print_Clk_Info_Line
  )
  
  &match=0
  &wild_head=0
  &wild_tail=0
  &clk_input_length=STRING.LENGTH("&clk")
  &clk_itr_length=STRING.LENGTH("gcc_mss_tbu_Q6_axi_clk")

  if (STRING.SCAN("&clk", "*", 0)==0)
  (
    &wild_head=1
  )
  if (STRING.SCAN("&clk", "*", 1)==(STRING.LENGTH("&clk")-1))
  (
    &wild_tail=1
  )

  if ((&wild_head==1)&&(&wild_tail==1))
  (
    if (STRING.SCAN("gcc_mss_tbu_Q6_axi_clk", STRING.MID("&clk", 1, &clk_input_length-2), 0)!=-1)
    ( 
      &match=1
    )
  )
  else if (&wild_head==1)
  (
    if (STRING.MID("gcc_mss_tbu_Q6_axi_clk", &clk_itr_length-&clk_input_length+1, &clk_input_length-1)==STRING.CUT("&clk", 1))
    ( 
      &match=1
    )
  )
  else if (&wild_tail==1)
  (
    if (STRING.MID("gcc_mss_tbu_Q6_axi_clk", 0, &clk_input_length-1)==STRING.CUT("&clk", -1))
    ( 
      &match=1
    )
  )	  
  else if ("gcc_mss_tbu_Q6_axi_clk"=="&clk")
  (
    &match=1
  )
  
  if (&match==1)
  (
    &clk_test=&CLK_TEST_GCC_MSS_TBU_Q6_AXI_CLK
    &clk_reg=&HWIO_GCC_MSS_TBU_Q6_AXI_CBCR_ADDR
    &clk_reg_name="GCC_MSS_TBU_Q6_AXI_CBCR"
    &clk_name="gcc_mss_tbu_Q6_axi_clk"
    &clk_reg_cbcr_type="sm_pscbc"

    gosub Print_Clk_Info_Line
  )
  
  &match=0
  &wild_head=0
  &wild_tail=0
  &clk_input_length=STRING.LENGTH("&clk")
  &clk_itr_length=STRING.LENGTH("gcc_mss_tbu_axi_clk")

  if (STRING.SCAN("&clk", "*", 0)==0)
  (
    &wild_head=1
  )
  if (STRING.SCAN("&clk", "*", 1)==(STRING.LENGTH("&clk")-1))
  (
    &wild_tail=1
  )

  if ((&wild_head==1)&&(&wild_tail==1))
  (
    if (STRING.SCAN("gcc_mss_tbu_axi_clk", STRING.MID("&clk", 1, &clk_input_length-2), 0)!=-1)
    ( 
      &match=1
    )
  )
  else if (&wild_head==1)
  (
    if (STRING.MID("gcc_mss_tbu_axi_clk", &clk_itr_length-&clk_input_length+1, &clk_input_length-1)==STRING.CUT("&clk", 1))
    ( 
      &match=1
    )
  )
  else if (&wild_tail==1)
  (
    if (STRING.MID("gcc_mss_tbu_axi_clk", 0, &clk_input_length-1)==STRING.CUT("&clk", -1))
    ( 
      &match=1
    )
  )	  
  else if ("gcc_mss_tbu_axi_clk"=="&clk")
  (
    &match=1
  )
  
  if (&match==1)
  (
    &clk_test=&CLK_TEST_GCC_MSS_TBU_AXI_CLK
    &clk_reg=&HWIO_GCC_MSS_TBU_AXI_CBCR_ADDR
    &clk_reg_name="GCC_MSS_TBU_AXI_CBCR"
    &clk_name="gcc_mss_tbu_axi_clk"
    &clk_reg_cbcr_type="sm_pscbc"

    gosub Print_Clk_Info_Line
  )
  
  &match=0
  &wild_head=0
  &wild_tail=0
  &clk_input_length=STRING.LENGTH("&clk")
  &clk_itr_length=STRING.LENGTH("gcc_mss_tbu_gss_axi_clk")

  if (STRING.SCAN("&clk", "*", 0)==0)
  (
    &wild_head=1
  )
  if (STRING.SCAN("&clk", "*", 1)==(STRING.LENGTH("&clk")-1))
  (
    &wild_tail=1
  )

  if ((&wild_head==1)&&(&wild_tail==1))
  (
    if (STRING.SCAN("gcc_mss_tbu_gss_axi_clk", STRING.MID("&clk", 1, &clk_input_length-2), 0)!=-1)
    ( 
      &match=1
    )
  )
  else if (&wild_head==1)
  (
    if (STRING.MID("gcc_mss_tbu_gss_axi_clk", &clk_itr_length-&clk_input_length+1, &clk_input_length-1)==STRING.CUT("&clk", 1))
    ( 
      &match=1
    )
  )
  else if (&wild_tail==1)
  (
    if (STRING.MID("gcc_mss_tbu_gss_axi_clk", 0, &clk_input_length-1)==STRING.CUT("&clk", -1))
    ( 
      &match=1
    )
  )	  
  else if ("gcc_mss_tbu_gss_axi_clk"=="&clk")
  (
    &match=1
  )
  
  if (&match==1)
  (
    &clk_test=&CLK_TEST_GCC_MSS_TBU_GSS_AXI_CLK
    &clk_reg=&HWIO_GCC_MSS_TBU_GSS_AXI_CBCR_ADDR
    &clk_reg_name="GCC_MSS_TBU_GSS_AXI_CBCR"
    &clk_name="gcc_mss_tbu_gss_axi_clk"
    &clk_reg_cbcr_type="sm_pscbc"

    gosub Print_Clk_Info_Line
  )
  
  &match=0
  &wild_head=0
  &wild_tail=0
  &clk_input_length=STRING.LENGTH("&clk")
  &clk_itr_length=STRING.LENGTH("gcc_pcnoc_tbu_clk")

  if (STRING.SCAN("&clk", "*", 0)==0)
  (
    &wild_head=1
  )
  if (STRING.SCAN("&clk", "*", 1)==(STRING.LENGTH("&clk")-1))
  (
    &wild_tail=1
  )

  if ((&wild_head==1)&&(&wild_tail==1))
  (
    if (STRING.SCAN("gcc_pcnoc_tbu_clk", STRING.MID("&clk", 1, &clk_input_length-2), 0)!=-1)
    ( 
      &match=1
    )
  )
  else if (&wild_head==1)
  (
    if (STRING.MID("gcc_pcnoc_tbu_clk", &clk_itr_length-&clk_input_length+1, &clk_input_length-1)==STRING.CUT("&clk", 1))
    ( 
      &match=1
    )
  )
  else if (&wild_tail==1)
  (
    if (STRING.MID("gcc_pcnoc_tbu_clk", 0, &clk_input_length-1)==STRING.CUT("&clk", -1))
    ( 
      &match=1
    )
  )	  
  else if ("gcc_pcnoc_tbu_clk"=="&clk")
  (
    &match=1
  )
  
  if (&match==1)
  (
    &clk_test=&CLK_TEST_GCC_PCNOC_TBU_CLK
    &clk_reg=&HWIO_GCC_PCNOC_TBU_CBCR_ADDR
    &clk_reg_name="GCC_PCNOC_TBU_CBCR"
    &clk_name="gcc_pcnoc_tbu_clk"
    &clk_reg_cbcr_type="sm_cbc"

    gosub Print_Clk_Info_Line
  )
  
  &match=0
  &wild_head=0
  &wild_tail=0
  &clk_input_length=STRING.LENGTH("&clk")
  &clk_itr_length=STRING.LENGTH("gcc_pronto_tbu_clk")

  if (STRING.SCAN("&clk", "*", 0)==0)
  (
    &wild_head=1
  )
  if (STRING.SCAN("&clk", "*", 1)==(STRING.LENGTH("&clk")-1))
  (
    &wild_tail=1
  )

  if ((&wild_head==1)&&(&wild_tail==1))
  (
    if (STRING.SCAN("gcc_pronto_tbu_clk", STRING.MID("&clk", 1, &clk_input_length-2), 0)!=-1)
    ( 
      &match=1
    )
  )
  else if (&wild_head==1)
  (
    if (STRING.MID("gcc_pronto_tbu_clk", &clk_itr_length-&clk_input_length+1, &clk_input_length-1)==STRING.CUT("&clk", 1))
    ( 
      &match=1
    )
  )
  else if (&wild_tail==1)
  (
    if (STRING.MID("gcc_pronto_tbu_clk", 0, &clk_input_length-1)==STRING.CUT("&clk", -1))
    ( 
      &match=1
    )
  )	  
  else if ("gcc_pronto_tbu_clk"=="&clk")
  (
    &match=1
  )
  
  if (&match==1)
  (
    &clk_test=&CLK_TEST_GCC_PRONTO_TBU_CLK
    &clk_reg=&HWIO_GCC_PRONTO_TBU_CBCR_ADDR
    &clk_reg_name="GCC_PRONTO_TBU_CBCR"
    &clk_name="gcc_pronto_tbu_clk"
    &clk_reg_cbcr_type="sm_pscbc"

    gosub Print_Clk_Info_Line
  )
  
  &match=0
  &wild_head=0
  &wild_tail=0
  &clk_input_length=STRING.LENGTH("&clk")
  &clk_itr_length=STRING.LENGTH("gcc_smmu_cats_clk")

  if (STRING.SCAN("&clk", "*", 0)==0)
  (
    &wild_head=1
  )
  if (STRING.SCAN("&clk", "*", 1)==(STRING.LENGTH("&clk")-1))
  (
    &wild_tail=1
  )

  if ((&wild_head==1)&&(&wild_tail==1))
  (
    if (STRING.SCAN("gcc_smmu_cats_clk", STRING.MID("&clk", 1, &clk_input_length-2), 0)!=-1)
    ( 
      &match=1
    )
  )
  else if (&wild_head==1)
  (
    if (STRING.MID("gcc_smmu_cats_clk", &clk_itr_length-&clk_input_length+1, &clk_input_length-1)==STRING.CUT("&clk", 1))
    ( 
      &match=1
    )
  )
  else if (&wild_tail==1)
  (
    if (STRING.MID("gcc_smmu_cats_clk", 0, &clk_input_length-1)==STRING.CUT("&clk", -1))
    ( 
      &match=1
    )
  )	  
  else if ("gcc_smmu_cats_clk"=="&clk")
  (
    &match=1
  )
  
  if (&match==1)
  (
    &clk_test=&CLK_TEST_GCC_SMMU_CATS_CLK
    &clk_reg=&HWIO_GCC_SMMU_CATS_CBCR_ADDR
    &clk_reg_name="GCC_SMMU_CATS_CBCR"
    &clk_name="gcc_smmu_cats_clk"
    &clk_reg_cbcr_type="sm_cbc"

    gosub Print_Clk_Info_Line
  )
  
  &match=0
  &wild_head=0
  &wild_tail=0
  &clk_input_length=STRING.LENGTH("&clk")
  &clk_itr_length=STRING.LENGTH("gcc_smmu_cfg_clk")

  if (STRING.SCAN("&clk", "*", 0)==0)
  (
    &wild_head=1
  )
  if (STRING.SCAN("&clk", "*", 1)==(STRING.LENGTH("&clk")-1))
  (
    &wild_tail=1
  )

  if ((&wild_head==1)&&(&wild_tail==1))
  (
    if (STRING.SCAN("gcc_smmu_cfg_clk", STRING.MID("&clk", 1, &clk_input_length-2), 0)!=-1)
    ( 
      &match=1
    )
  )
  else if (&wild_head==1)
  (
    if (STRING.MID("gcc_smmu_cfg_clk", &clk_itr_length-&clk_input_length+1, &clk_input_length-1)==STRING.CUT("&clk", 1))
    ( 
      &match=1
    )
  )
  else if (&wild_tail==1)
  (
    if (STRING.MID("gcc_smmu_cfg_clk", 0, &clk_input_length-1)==STRING.CUT("&clk", -1))
    ( 
      &match=1
    )
  )	  
  else if ("gcc_smmu_cfg_clk"=="&clk")
  (
    &match=1
  )
  
  if (&match==1)
  (
    &clk_test=&CLK_TEST_GCC_SMMU_CFG_CLK
    &clk_reg=&HWIO_GCC_SMMU_CFG_CBCR_ADDR
    &clk_reg_name="GCC_SMMU_CFG_CBCR"
    &clk_name="gcc_smmu_cfg_clk"
    &clk_reg_cbcr_type="sm_cbc"

    gosub Print_Clk_Info_Line
  )
  
  &match=0
  &wild_head=0
  &wild_tail=0
  &clk_input_length=STRING.LENGTH("&clk")
  &clk_itr_length=STRING.LENGTH("gcc_smmu_xpu_clk")

  if (STRING.SCAN("&clk", "*", 0)==0)
  (
    &wild_head=1
  )
  if (STRING.SCAN("&clk", "*", 1)==(STRING.LENGTH("&clk")-1))
  (
    &wild_tail=1
  )

  if ((&wild_head==1)&&(&wild_tail==1))
  (
    if (STRING.SCAN("gcc_smmu_xpu_clk", STRING.MID("&clk", 1, &clk_input_length-2), 0)!=-1)
    ( 
      &match=1
    )
  )
  else if (&wild_head==1)
  (
    if (STRING.MID("gcc_smmu_xpu_clk", &clk_itr_length-&clk_input_length+1, &clk_input_length-1)==STRING.CUT("&clk", 1))
    ( 
      &match=1
    )
  )
  else if (&wild_tail==1)
  (
    if (STRING.MID("gcc_smmu_xpu_clk", 0, &clk_input_length-1)==STRING.CUT("&clk", -1))
    ( 
      &match=1
    )
  )	  
  else if ("gcc_smmu_xpu_clk"=="&clk")
  (
    &match=1
  )
  
  if (&match==1)
  (
    &clk_test=&CLK_TEST_GCC_SMMU_XPU_CLK
    &clk_reg=&HWIO_GCC_SMMU_XPU_CBCR_ADDR
    &clk_reg_name="GCC_SMMU_XPU_CBCR"
    &clk_name="gcc_smmu_xpu_clk"
    &clk_reg_cbcr_type="sm_cbc"

    gosub Print_Clk_Info_Line
  )
  
  &match=0
  &wild_head=0
  &wild_tail=0
  &clk_input_length=STRING.LENGTH("&clk")
  &clk_itr_length=STRING.LENGTH("gcc_venus_tbu_clk")

  if (STRING.SCAN("&clk", "*", 0)==0)
  (
    &wild_head=1
  )
  if (STRING.SCAN("&clk", "*", 1)==(STRING.LENGTH("&clk")-1))
  (
    &wild_tail=1
  )

  if ((&wild_head==1)&&(&wild_tail==1))
  (
    if (STRING.SCAN("gcc_venus_tbu_clk", STRING.MID("&clk", 1, &clk_input_length-2), 0)!=-1)
    ( 
      &match=1
    )
  )
  else if (&wild_head==1)
  (
    if (STRING.MID("gcc_venus_tbu_clk", &clk_itr_length-&clk_input_length+1, &clk_input_length-1)==STRING.CUT("&clk", 1))
    ( 
      &match=1
    )
  )
  else if (&wild_tail==1)
  (
    if (STRING.MID("gcc_venus_tbu_clk", 0, &clk_input_length-1)==STRING.CUT("&clk", -1))
    ( 
      &match=1
    )
  )	  
  else if ("gcc_venus_tbu_clk"=="&clk")
  (
    &match=1
  )
  
  if (&match==1)
  (
    &clk_test=&CLK_TEST_GCC_VENUS_TBU_CLK
    &clk_reg=&HWIO_GCC_VENUS_TBU_CBCR_ADDR
    &clk_reg_name="GCC_VENUS_TBU_CBCR"
    &clk_name="gcc_venus_tbu_clk"
    &clk_reg_cbcr_type="sm_pscbc"

    gosub Print_Clk_Info_Line
  )
  
  &match=0
  &wild_head=0
  &wild_tail=0
  &clk_input_length=STRING.LENGTH("&clk")
  &clk_itr_length=STRING.LENGTH("gcc_vfe_tbu_clk")

  if (STRING.SCAN("&clk", "*", 0)==0)
  (
    &wild_head=1
  )
  if (STRING.SCAN("&clk", "*", 1)==(STRING.LENGTH("&clk")-1))
  (
    &wild_tail=1
  )

  if ((&wild_head==1)&&(&wild_tail==1))
  (
    if (STRING.SCAN("gcc_vfe_tbu_clk", STRING.MID("&clk", 1, &clk_input_length-2), 0)!=-1)
    ( 
      &match=1
    )
  )
  else if (&wild_head==1)
  (
    if (STRING.MID("gcc_vfe_tbu_clk", &clk_itr_length-&clk_input_length+1, &clk_input_length-1)==STRING.CUT("&clk", 1))
    ( 
      &match=1
    )
  )
  else if (&wild_tail==1)
  (
    if (STRING.MID("gcc_vfe_tbu_clk", 0, &clk_input_length-1)==STRING.CUT("&clk", -1))
    ( 
      &match=1
    )
  )	  
  else if ("gcc_vfe_tbu_clk"=="&clk")
  (
    &match=1
  )
  
  if (&match==1)
  (
    &clk_test=&CLK_TEST_GCC_VFE_TBU_CLK
    &clk_reg=&HWIO_GCC_VFE_TBU_CBCR_ADDR
    &clk_reg_name="GCC_VFE_TBU_CBCR"
    &clk_name="gcc_vfe_tbu_clk"
    &clk_reg_cbcr_type="sm_cbc"

    gosub Print_Clk_Info_Line
  )
  
  &match=0
  &wild_head=0
  &wild_tail=0
  &clk_input_length=STRING.LENGTH("&clk")
  &clk_itr_length=STRING.LENGTH("gcc_snoc_bus_timeout0_ahb_clk")

  if (STRING.SCAN("&clk", "*", 0)==0)
  (
    &wild_head=1
  )
  if (STRING.SCAN("&clk", "*", 1)==(STRING.LENGTH("&clk")-1))
  (
    &wild_tail=1
  )

  if ((&wild_head==1)&&(&wild_tail==1))
  (
    if (STRING.SCAN("gcc_snoc_bus_timeout0_ahb_clk", STRING.MID("&clk", 1, &clk_input_length-2), 0)!=-1)
    ( 
      &match=1
    )
  )
  else if (&wild_head==1)
  (
    if (STRING.MID("gcc_snoc_bus_timeout0_ahb_clk", &clk_itr_length-&clk_input_length+1, &clk_input_length-1)==STRING.CUT("&clk", 1))
    ( 
      &match=1
    )
  )
  else if (&wild_tail==1)
  (
    if (STRING.MID("gcc_snoc_bus_timeout0_ahb_clk", 0, &clk_input_length-1)==STRING.CUT("&clk", -1))
    ( 
      &match=1
    )
  )	  
  else if ("gcc_snoc_bus_timeout0_ahb_clk"=="&clk")
  (
    &match=1
  )
  
  if (&match==1)
  (
    &clk_test=&CLK_TEST_GCC_SNOC_BUS_TIMEOUT0_AHB_CLK
    &clk_reg=&HWIO_GCC_SNOC_BUS_TIMEOUT0_AHB_CBCR_ADDR
    &clk_reg_name="GCC_SNOC_BUS_TIMEOUT0_AHB_CBCR"
    &clk_name="gcc_snoc_bus_timeout0_ahb_clk"
    &clk_reg_cbcr_type="sm_cbc"

    gosub Print_Clk_Info_Line
  )
  
  &match=0
  &wild_head=0
  &wild_tail=0
  &clk_input_length=STRING.LENGTH("&clk")
  &clk_itr_length=STRING.LENGTH("gcc_spdm_bimc_cy_clk")

  if (STRING.SCAN("&clk", "*", 0)==0)
  (
    &wild_head=1
  )
  if (STRING.SCAN("&clk", "*", 1)==(STRING.LENGTH("&clk")-1))
  (
    &wild_tail=1
  )

  if ((&wild_head==1)&&(&wild_tail==1))
  (
    if (STRING.SCAN("gcc_spdm_bimc_cy_clk", STRING.MID("&clk", 1, &clk_input_length-2), 0)!=-1)
    ( 
      &match=1
    )
  )
  else if (&wild_head==1)
  (
    if (STRING.MID("gcc_spdm_bimc_cy_clk", &clk_itr_length-&clk_input_length+1, &clk_input_length-1)==STRING.CUT("&clk", 1))
    ( 
      &match=1
    )
  )
  else if (&wild_tail==1)
  (
    if (STRING.MID("gcc_spdm_bimc_cy_clk", 0, &clk_input_length-1)==STRING.CUT("&clk", -1))
    ( 
      &match=1
    )
  )	  
  else if ("gcc_spdm_bimc_cy_clk"=="&clk")
  (
    &match=1
  )
  
  if (&match==1)
  (
    &clk_test=&CLK_TEST_GCC_SPDM_BIMC_CY_CLK
    &clk_reg=&HWIO_GCC_SPDM_BIMC_CY_CBCR_ADDR
    &clk_reg_name="GCC_SPDM_BIMC_CY_CBCR"
    &clk_name="gcc_spdm_bimc_cy_clk"
    &clk_reg_cbcr_type="sm_cbc"

    gosub Print_Clk_Info_Line
  )
  
  &match=0
  &wild_head=0
  &wild_tail=0
  &clk_input_length=STRING.LENGTH("&clk")
  &clk_itr_length=STRING.LENGTH("gcc_spdm_cfg_ahb_clk")

  if (STRING.SCAN("&clk", "*", 0)==0)
  (
    &wild_head=1
  )
  if (STRING.SCAN("&clk", "*", 1)==(STRING.LENGTH("&clk")-1))
  (
    &wild_tail=1
  )

  if ((&wild_head==1)&&(&wild_tail==1))
  (
    if (STRING.SCAN("gcc_spdm_cfg_ahb_clk", STRING.MID("&clk", 1, &clk_input_length-2), 0)!=-1)
    ( 
      &match=1
    )
  )
  else if (&wild_head==1)
  (
    if (STRING.MID("gcc_spdm_cfg_ahb_clk", &clk_itr_length-&clk_input_length+1, &clk_input_length-1)==STRING.CUT("&clk", 1))
    ( 
      &match=1
    )
  )
  else if (&wild_tail==1)
  (
    if (STRING.MID("gcc_spdm_cfg_ahb_clk", 0, &clk_input_length-1)==STRING.CUT("&clk", -1))
    ( 
      &match=1
    )
  )	  
  else if ("gcc_spdm_cfg_ahb_clk"=="&clk")
  (
    &match=1
  )
  
  if (&match==1)
  (
    &clk_test=&CLK_TEST_GCC_SPDM_CFG_AHB_CLK
    &clk_reg=&HWIO_GCC_SPDM_CFG_AHB_CBCR_ADDR
    &clk_reg_name="GCC_SPDM_CFG_AHB_CBCR"
    &clk_name="gcc_spdm_cfg_ahb_clk"
    &clk_reg_cbcr_type="sm_cbc"

    gosub Print_Clk_Info_Line
  )
  
  &match=0
  &wild_head=0
  &wild_tail=0
  &clk_input_length=STRING.LENGTH("&clk")
  &clk_itr_length=STRING.LENGTH("gcc_spdm_ff_clk")

  if (STRING.SCAN("&clk", "*", 0)==0)
  (
    &wild_head=1
  )
  if (STRING.SCAN("&clk", "*", 1)==(STRING.LENGTH("&clk")-1))
  (
    &wild_tail=1
  )

  if ((&wild_head==1)&&(&wild_tail==1))
  (
    if (STRING.SCAN("gcc_spdm_ff_clk", STRING.MID("&clk", 1, &clk_input_length-2), 0)!=-1)
    ( 
      &match=1
    )
  )
  else if (&wild_head==1)
  (
    if (STRING.MID("gcc_spdm_ff_clk", &clk_itr_length-&clk_input_length+1, &clk_input_length-1)==STRING.CUT("&clk", 1))
    ( 
      &match=1
    )
  )
  else if (&wild_tail==1)
  (
    if (STRING.MID("gcc_spdm_ff_clk", 0, &clk_input_length-1)==STRING.CUT("&clk", -1))
    ( 
      &match=1
    )
  )	  
  else if ("gcc_spdm_ff_clk"=="&clk")
  (
    &match=1
  )
  
  if (&match==1)
  (
    &clk_test=&CLK_TEST_GCC_SPDM_FF_CLK
    &clk_reg=&HWIO_GCC_SPDM_FF_CBCR_ADDR
    &clk_reg_name="GCC_SPDM_FF_CBCR"
    &clk_name="gcc_spdm_ff_clk"
    &clk_reg_cbcr_type="sm_cbc"

    gosub Print_Clk_Info_Line
  )
  
  &match=0
  &wild_head=0
  &wild_tail=0
  &clk_input_length=STRING.LENGTH("&clk")
  &clk_itr_length=STRING.LENGTH("gcc_spdm_mstr_ahb_clk")

  if (STRING.SCAN("&clk", "*", 0)==0)
  (
    &wild_head=1
  )
  if (STRING.SCAN("&clk", "*", 1)==(STRING.LENGTH("&clk")-1))
  (
    &wild_tail=1
  )

  if ((&wild_head==1)&&(&wild_tail==1))
  (
    if (STRING.SCAN("gcc_spdm_mstr_ahb_clk", STRING.MID("&clk", 1, &clk_input_length-2), 0)!=-1)
    ( 
      &match=1
    )
  )
  else if (&wild_head==1)
  (
    if (STRING.MID("gcc_spdm_mstr_ahb_clk", &clk_itr_length-&clk_input_length+1, &clk_input_length-1)==STRING.CUT("&clk", 1))
    ( 
      &match=1
    )
  )
  else if (&wild_tail==1)
  (
    if (STRING.MID("gcc_spdm_mstr_ahb_clk", 0, &clk_input_length-1)==STRING.CUT("&clk", -1))
    ( 
      &match=1
    )
  )	  
  else if ("gcc_spdm_mstr_ahb_clk"=="&clk")
  (
    &match=1
  )
  
  if (&match==1)
  (
    &clk_test=&CLK_TEST_GCC_SPDM_MSTR_AHB_CLK
    &clk_reg=&HWIO_GCC_SPDM_MSTR_AHB_CBCR_ADDR
    &clk_reg_name="GCC_SPDM_MSTR_AHB_CBCR"
    &clk_name="gcc_spdm_mstr_ahb_clk"
    &clk_reg_cbcr_type="sm_cbc"

    gosub Print_Clk_Info_Line
  )
  
  &match=0
  &wild_head=0
  &wild_tail=0
  &clk_input_length=STRING.LENGTH("&clk")
  &clk_itr_length=STRING.LENGTH("gcc_spdm_pcnoc_cy_clk")

  if (STRING.SCAN("&clk", "*", 0)==0)
  (
    &wild_head=1
  )
  if (STRING.SCAN("&clk", "*", 1)==(STRING.LENGTH("&clk")-1))
  (
    &wild_tail=1
  )

  if ((&wild_head==1)&&(&wild_tail==1))
  (
    if (STRING.SCAN("gcc_spdm_pcnoc_cy_clk", STRING.MID("&clk", 1, &clk_input_length-2), 0)!=-1)
    ( 
      &match=1
    )
  )
  else if (&wild_head==1)
  (
    if (STRING.MID("gcc_spdm_pcnoc_cy_clk", &clk_itr_length-&clk_input_length+1, &clk_input_length-1)==STRING.CUT("&clk", 1))
    ( 
      &match=1
    )
  )
  else if (&wild_tail==1)
  (
    if (STRING.MID("gcc_spdm_pcnoc_cy_clk", 0, &clk_input_length-1)==STRING.CUT("&clk", -1))
    ( 
      &match=1
    )
  )	  
  else if ("gcc_spdm_pcnoc_cy_clk"=="&clk")
  (
    &match=1
  )
  
  if (&match==1)
  (
    &clk_test=&CLK_TEST_GCC_SPDM_PCNOC_CY_CLK
    &clk_reg=&HWIO_GCC_SPDM_PCNOC_CY_CBCR_ADDR
    &clk_reg_name="GCC_SPDM_PCNOC_CY_CBCR"
    &clk_name="gcc_spdm_pcnoc_cy_clk"
    &clk_reg_cbcr_type="sm_cbc"

    gosub Print_Clk_Info_Line
  )
  
  &match=0
  &wild_head=0
  &wild_tail=0
  &clk_input_length=STRING.LENGTH("&clk")
  &clk_itr_length=STRING.LENGTH("gcc_spdm_rpm_cy_clk")

  if (STRING.SCAN("&clk", "*", 0)==0)
  (
    &wild_head=1
  )
  if (STRING.SCAN("&clk", "*", 1)==(STRING.LENGTH("&clk")-1))
  (
    &wild_tail=1
  )

  if ((&wild_head==1)&&(&wild_tail==1))
  (
    if (STRING.SCAN("gcc_spdm_rpm_cy_clk", STRING.MID("&clk", 1, &clk_input_length-2), 0)!=-1)
    ( 
      &match=1
    )
  )
  else if (&wild_head==1)
  (
    if (STRING.MID("gcc_spdm_rpm_cy_clk", &clk_itr_length-&clk_input_length+1, &clk_input_length-1)==STRING.CUT("&clk", 1))
    ( 
      &match=1
    )
  )
  else if (&wild_tail==1)
  (
    if (STRING.MID("gcc_spdm_rpm_cy_clk", 0, &clk_input_length-1)==STRING.CUT("&clk", -1))
    ( 
      &match=1
    )
  )	  
  else if ("gcc_spdm_rpm_cy_clk"=="&clk")
  (
    &match=1
  )
  
  if (&match==1)
  (
    &clk_test=&CLK_TEST_GCC_SPDM_RPM_CY_CLK
    &clk_reg=&HWIO_GCC_SPDM_RPM_CY_CBCR_ADDR
    &clk_reg_name="GCC_SPDM_RPM_CY_CBCR"
    &clk_name="gcc_spdm_rpm_cy_clk"
    &clk_reg_cbcr_type="sm_cbc"

    gosub Print_Clk_Info_Line
  )
  
  &match=0
  &wild_head=0
  &wild_tail=0
  &clk_input_length=STRING.LENGTH("&clk")
  &clk_itr_length=STRING.LENGTH("gcc_spdm_snoc_cy_clk")

  if (STRING.SCAN("&clk", "*", 0)==0)
  (
    &wild_head=1
  )
  if (STRING.SCAN("&clk", "*", 1)==(STRING.LENGTH("&clk")-1))
  (
    &wild_tail=1
  )

  if ((&wild_head==1)&&(&wild_tail==1))
  (
    if (STRING.SCAN("gcc_spdm_snoc_cy_clk", STRING.MID("&clk", 1, &clk_input_length-2), 0)!=-1)
    ( 
      &match=1
    )
  )
  else if (&wild_head==1)
  (
    if (STRING.MID("gcc_spdm_snoc_cy_clk", &clk_itr_length-&clk_input_length+1, &clk_input_length-1)==STRING.CUT("&clk", 1))
    ( 
      &match=1
    )
  )
  else if (&wild_tail==1)
  (
    if (STRING.MID("gcc_spdm_snoc_cy_clk", 0, &clk_input_length-1)==STRING.CUT("&clk", -1))
    ( 
      &match=1
    )
  )	  
  else if ("gcc_spdm_snoc_cy_clk"=="&clk")
  (
    &match=1
  )
  
  if (&match==1)
  (
    &clk_test=&CLK_TEST_GCC_SPDM_SNOC_CY_CLK
    &clk_reg=&HWIO_GCC_SPDM_SNOC_CY_CBCR_ADDR
    &clk_reg_name="GCC_SPDM_SNOC_CY_CBCR"
    &clk_name="gcc_spdm_snoc_cy_clk"
    &clk_reg_cbcr_type="sm_cbc"

    gosub Print_Clk_Info_Line
  )
  
  &match=0
  &wild_head=0
  &wild_tail=0
  &clk_input_length=STRING.LENGTH("&clk")
  &clk_itr_length=STRING.LENGTH("gcc_ultaudio_ahbfabric_efabric_spdm_clk")

  if (STRING.SCAN("&clk", "*", 0)==0)
  (
    &wild_head=1
  )
  if (STRING.SCAN("&clk", "*", 1)==(STRING.LENGTH("&clk")-1))
  (
    &wild_tail=1
  )

  if ((&wild_head==1)&&(&wild_tail==1))
  (
    if (STRING.SCAN("gcc_ultaudio_ahbfabric_efabric_spdm_clk", STRING.MID("&clk", 1, &clk_input_length-2), 0)!=-1)
    ( 
      &match=1
    )
  )
  else if (&wild_head==1)
  (
    if (STRING.MID("gcc_ultaudio_ahbfabric_efabric_spdm_clk", &clk_itr_length-&clk_input_length+1, &clk_input_length-1)==STRING.CUT("&clk", 1))
    ( 
      &match=1
    )
  )
  else if (&wild_tail==1)
  (
    if (STRING.MID("gcc_ultaudio_ahbfabric_efabric_spdm_clk", 0, &clk_input_length-1)==STRING.CUT("&clk", -1))
    ( 
      &match=1
    )
  )	  
  else if ("gcc_ultaudio_ahbfabric_efabric_spdm_clk"=="&clk")
  (
    &match=1
  )
  
  if (&match==1)
  (
    &clk_test=&CLK_TEST_GCC_ULTAUDIO_AHBFABRIC_EFABRIC_SPDM_CLK
    &clk_reg=&HWIO_GCC_ULTAUDIO_AHBFABRIC_EFABRIC_SPDM_CBCR_ADDR
    &clk_reg_name="GCC_ULTAUDIO_AHBFABRIC_EFABRIC_SPDM_CBCR"
    &clk_name="gcc_ultaudio_ahbfabric_efabric_spdm_clk"
    &clk_reg_cbcr_type="sm_cbc"

    gosub Print_Clk_Info_Line
  )
  
  &match=0
  &wild_head=0
  &wild_tail=0
  &clk_input_length=STRING.LENGTH("&clk")
  &clk_itr_length=STRING.LENGTH("gcc_spmi_ahb_clk")

  if (STRING.SCAN("&clk", "*", 0)==0)
  (
    &wild_head=1
  )
  if (STRING.SCAN("&clk", "*", 1)==(STRING.LENGTH("&clk")-1))
  (
    &wild_tail=1
  )

  if ((&wild_head==1)&&(&wild_tail==1))
  (
    if (STRING.SCAN("gcc_spmi_ahb_clk", STRING.MID("&clk", 1, &clk_input_length-2), 0)!=-1)
    ( 
      &match=1
    )
  )
  else if (&wild_head==1)
  (
    if (STRING.MID("gcc_spmi_ahb_clk", &clk_itr_length-&clk_input_length+1, &clk_input_length-1)==STRING.CUT("&clk", 1))
    ( 
      &match=1
    )
  )
  else if (&wild_tail==1)
  (
    if (STRING.MID("gcc_spmi_ahb_clk", 0, &clk_input_length-1)==STRING.CUT("&clk", -1))
    ( 
      &match=1
    )
  )	  
  else if ("gcc_spmi_ahb_clk"=="&clk")
  (
    &match=1
  )
  
  if (&match==1)
  (
    &clk_test=&CLK_TEST_GCC_SPMI_AHB_CLK
    &clk_reg=&HWIO_GCC_SPMI_AHB_CBCR_ADDR
    &clk_reg_name="GCC_SPMI_AHB_CBCR"
    &clk_name="gcc_spmi_ahb_clk"
    &clk_reg_cbcr_type="sm_pscbc"

    gosub Print_Clk_Info_Line
  )
  
  &match=0
  &wild_head=0
  &wild_tail=0
  &clk_input_length=STRING.LENGTH("&clk")
  &clk_itr_length=STRING.LENGTH("gcc_spmi_pcnoc_ahb_clk")

  if (STRING.SCAN("&clk", "*", 0)==0)
  (
    &wild_head=1
  )
  if (STRING.SCAN("&clk", "*", 1)==(STRING.LENGTH("&clk")-1))
  (
    &wild_tail=1
  )

  if ((&wild_head==1)&&(&wild_tail==1))
  (
    if (STRING.SCAN("gcc_spmi_pcnoc_ahb_clk", STRING.MID("&clk", 1, &clk_input_length-2), 0)!=-1)
    ( 
      &match=1
    )
  )
  else if (&wild_head==1)
  (
    if (STRING.MID("gcc_spmi_pcnoc_ahb_clk", &clk_itr_length-&clk_input_length+1, &clk_input_length-1)==STRING.CUT("&clk", 1))
    ( 
      &match=1
    )
  )
  else if (&wild_tail==1)
  (
    if (STRING.MID("gcc_spmi_pcnoc_ahb_clk", 0, &clk_input_length-1)==STRING.CUT("&clk", -1))
    ( 
      &match=1
    )
  )	  
  else if ("gcc_spmi_pcnoc_ahb_clk"=="&clk")
  (
    &match=1
  )
  
  if (&match==1)
  (
    &clk_test=&CLK_TEST_GCC_SPMI_PCNOC_AHB_CLK
    &clk_reg=&HWIO_GCC_SPMI_PCNOC_AHB_CBCR_ADDR
    &clk_reg_name="GCC_SPMI_PCNOC_AHB_CBCR"
    &clk_name="gcc_spmi_pcnoc_ahb_clk"
    &clk_reg_cbcr_type="sm_cbc"

    gosub Print_Clk_Info_Line
  )
  
  &match=0
  &wild_head=0
  &wild_tail=0
  &clk_input_length=STRING.LENGTH("&clk")
  &clk_itr_length=STRING.LENGTH("gcc_spmi_ser_clk")

  if (STRING.SCAN("&clk", "*", 0)==0)
  (
    &wild_head=1
  )
  if (STRING.SCAN("&clk", "*", 1)==(STRING.LENGTH("&clk")-1))
  (
    &wild_tail=1
  )

  if ((&wild_head==1)&&(&wild_tail==1))
  (
    if (STRING.SCAN("gcc_spmi_ser_clk", STRING.MID("&clk", 1, &clk_input_length-2), 0)!=-1)
    ( 
      &match=1
    )
  )
  else if (&wild_head==1)
  (
    if (STRING.MID("gcc_spmi_ser_clk", &clk_itr_length-&clk_input_length+1, &clk_input_length-1)==STRING.CUT("&clk", 1))
    ( 
      &match=1
    )
  )
  else if (&wild_tail==1)
  (
    if (STRING.MID("gcc_spmi_ser_clk", 0, &clk_input_length-1)==STRING.CUT("&clk", -1))
    ( 
      &match=1
    )
  )	  
  else if ("gcc_spmi_ser_clk"=="&clk")
  (
    &match=1
  )
  
  if (&match==1)
  (
    &clk_test=&CLK_TEST_GCC_SPMI_SER_CLK
    &clk_reg=&HWIO_GCC_SPMI_SER_CBCR_ADDR
    &clk_reg_name="GCC_SPMI_SER_CBCR"
    &clk_name="gcc_spmi_ser_clk"
    &clk_reg_cbcr_type="sm_pscbc"

    gosub Print_Clk_Info_Line
  )
  
  &match=0
  &wild_head=0
  &wild_tail=0
  &clk_input_length=STRING.LENGTH("&clk")
  &clk_itr_length=STRING.LENGTH("gcc_sec_ctrl_acc_clk")

  if (STRING.SCAN("&clk", "*", 0)==0)
  (
    &wild_head=1
  )
  if (STRING.SCAN("&clk", "*", 1)==(STRING.LENGTH("&clk")-1))
  (
    &wild_tail=1
  )

  if ((&wild_head==1)&&(&wild_tail==1))
  (
    if (STRING.SCAN("gcc_sec_ctrl_acc_clk", STRING.MID("&clk", 1, &clk_input_length-2), 0)!=-1)
    ( 
      &match=1
    )
  )
  else if (&wild_head==1)
  (
    if (STRING.MID("gcc_sec_ctrl_acc_clk", &clk_itr_length-&clk_input_length+1, &clk_input_length-1)==STRING.CUT("&clk", 1))
    ( 
      &match=1
    )
  )
  else if (&wild_tail==1)
  (
    if (STRING.MID("gcc_sec_ctrl_acc_clk", 0, &clk_input_length-1)==STRING.CUT("&clk", -1))
    ( 
      &match=1
    )
  )	  
  else if ("gcc_sec_ctrl_acc_clk"=="&clk")
  (
    &match=1
  )
  
  if (&match==1)
  (
    &clk_test=&CLK_TEST_GCC_SEC_CTRL_ACC_CLK
    &clk_reg=&HWIO_GCC_SEC_CTRL_ACC_CBCR_ADDR
    &clk_reg_name="GCC_SEC_CTRL_ACC_CBCR"
    &clk_name="gcc_sec_ctrl_acc_clk"
    &clk_reg_cbcr_type="sm_pscbc"

    gosub Print_Clk_Info_Line
  )
  
  &match=0
  &wild_head=0
  &wild_tail=0
  &clk_input_length=STRING.LENGTH("&clk")
  &clk_itr_length=STRING.LENGTH("gcc_sec_ctrl_ahb_clk")

  if (STRING.SCAN("&clk", "*", 0)==0)
  (
    &wild_head=1
  )
  if (STRING.SCAN("&clk", "*", 1)==(STRING.LENGTH("&clk")-1))
  (
    &wild_tail=1
  )

  if ((&wild_head==1)&&(&wild_tail==1))
  (
    if (STRING.SCAN("gcc_sec_ctrl_ahb_clk", STRING.MID("&clk", 1, &clk_input_length-2), 0)!=-1)
    ( 
      &match=1
    )
  )
  else if (&wild_head==1)
  (
    if (STRING.MID("gcc_sec_ctrl_ahb_clk", &clk_itr_length-&clk_input_length+1, &clk_input_length-1)==STRING.CUT("&clk", 1))
    ( 
      &match=1
    )
  )
  else if (&wild_tail==1)
  (
    if (STRING.MID("gcc_sec_ctrl_ahb_clk", 0, &clk_input_length-1)==STRING.CUT("&clk", -1))
    ( 
      &match=1
    )
  )	  
  else if ("gcc_sec_ctrl_ahb_clk"=="&clk")
  (
    &match=1
  )
  
  if (&match==1)
  (
    &clk_test=&CLK_TEST_GCC_SEC_CTRL_AHB_CLK
    &clk_reg=&HWIO_GCC_SEC_CTRL_AHB_CBCR_ADDR
    &clk_reg_name="GCC_SEC_CTRL_AHB_CBCR"
    &clk_name="gcc_sec_ctrl_ahb_clk"
    &clk_reg_cbcr_type="sm_cbc"

    gosub Print_Clk_Info_Line
  )
  
  &match=0
  &wild_head=0
  &wild_tail=0
  &clk_input_length=STRING.LENGTH("&clk")
  &clk_itr_length=STRING.LENGTH("gcc_sec_ctrl_boot_rom_patch_clk")

  if (STRING.SCAN("&clk", "*", 0)==0)
  (
    &wild_head=1
  )
  if (STRING.SCAN("&clk", "*", 1)==(STRING.LENGTH("&clk")-1))
  (
    &wild_tail=1
  )

  if ((&wild_head==1)&&(&wild_tail==1))
  (
    if (STRING.SCAN("gcc_sec_ctrl_boot_rom_patch_clk", STRING.MID("&clk", 1, &clk_input_length-2), 0)!=-1)
    ( 
      &match=1
    )
  )
  else if (&wild_head==1)
  (
    if (STRING.MID("gcc_sec_ctrl_boot_rom_patch_clk", &clk_itr_length-&clk_input_length+1, &clk_input_length-1)==STRING.CUT("&clk", 1))
    ( 
      &match=1
    )
  )
  else if (&wild_tail==1)
  (
    if (STRING.MID("gcc_sec_ctrl_boot_rom_patch_clk", 0, &clk_input_length-1)==STRING.CUT("&clk", -1))
    ( 
      &match=1
    )
  )	  
  else if ("gcc_sec_ctrl_boot_rom_patch_clk"=="&clk")
  (
    &match=1
  )
  
  if (&match==1)
  (
    &clk_test=&CLK_TEST_GCC_SEC_CTRL_BOOT_ROM_PATCH_CLK
    &clk_reg=&HWIO_GCC_SEC_CTRL_BOOT_ROM_PATCH_CBCR_ADDR
    &clk_reg_name="GCC_SEC_CTRL_BOOT_ROM_PATCH_CBCR"
    &clk_name="gcc_sec_ctrl_boot_rom_patch_clk"
    &clk_reg_cbcr_type="sm_cbc"

    gosub Print_Clk_Info_Line
  )
  
  &match=0
  &wild_head=0
  &wild_tail=0
  &clk_input_length=STRING.LENGTH("&clk")
  &clk_itr_length=STRING.LENGTH("gcc_sec_ctrl_clk")

  if (STRING.SCAN("&clk", "*", 0)==0)
  (
    &wild_head=1
  )
  if (STRING.SCAN("&clk", "*", 1)==(STRING.LENGTH("&clk")-1))
  (
    &wild_tail=1
  )

  if ((&wild_head==1)&&(&wild_tail==1))
  (
    if (STRING.SCAN("gcc_sec_ctrl_clk", STRING.MID("&clk", 1, &clk_input_length-2), 0)!=-1)
    ( 
      &match=1
    )
  )
  else if (&wild_head==1)
  (
    if (STRING.MID("gcc_sec_ctrl_clk", &clk_itr_length-&clk_input_length+1, &clk_input_length-1)==STRING.CUT("&clk", 1))
    ( 
      &match=1
    )
  )
  else if (&wild_tail==1)
  (
    if (STRING.MID("gcc_sec_ctrl_clk", 0, &clk_input_length-1)==STRING.CUT("&clk", -1))
    ( 
      &match=1
    )
  )	  
  else if ("gcc_sec_ctrl_clk"=="&clk")
  (
    &match=1
  )
  
  if (&match==1)
  (
    &clk_test=&CLK_TEST_GCC_SEC_CTRL_CLK
    &clk_reg=&HWIO_GCC_SEC_CTRL_CBCR_ADDR
    &clk_reg_name="GCC_SEC_CTRL_CBCR"
    &clk_name="gcc_sec_ctrl_clk"
    &clk_reg_cbcr_type="sm_pscbc"

    gosub Print_Clk_Info_Line
  )
  
  &match=0
  &wild_head=0
  &wild_tail=0
  &clk_input_length=STRING.LENGTH("&clk")
  &clk_itr_length=STRING.LENGTH("gcc_sec_ctrl_sense_clk")

  if (STRING.SCAN("&clk", "*", 0)==0)
  (
    &wild_head=1
  )
  if (STRING.SCAN("&clk", "*", 1)==(STRING.LENGTH("&clk")-1))
  (
    &wild_tail=1
  )

  if ((&wild_head==1)&&(&wild_tail==1))
  (
    if (STRING.SCAN("gcc_sec_ctrl_sense_clk", STRING.MID("&clk", 1, &clk_input_length-2), 0)!=-1)
    ( 
      &match=1
    )
  )
  else if (&wild_head==1)
  (
    if (STRING.MID("gcc_sec_ctrl_sense_clk", &clk_itr_length-&clk_input_length+1, &clk_input_length-1)==STRING.CUT("&clk", 1))
    ( 
      &match=1
    )
  )
  else if (&wild_tail==1)
  (
    if (STRING.MID("gcc_sec_ctrl_sense_clk", 0, &clk_input_length-1)==STRING.CUT("&clk", -1))
    ( 
      &match=1
    )
  )	  
  else if ("gcc_sec_ctrl_sense_clk"=="&clk")
  (
    &match=1
  )
  
  if (&match==1)
  (
    &clk_test=&CLK_TEST_GCC_SEC_CTRL_SENSE_CLK
    &clk_reg=&HWIO_GCC_SEC_CTRL_SENSE_CBCR_ADDR
    &clk_reg_name="GCC_SEC_CTRL_SENSE_CBCR"
    &clk_name="gcc_sec_ctrl_sense_clk"
    &clk_reg_cbcr_type="sm_cbc"

    gosub Print_Clk_Info_Line
  )
  
  &match=0
  &wild_head=0
  &wild_tail=0
  &clk_input_length=STRING.LENGTH("&clk")
  &clk_itr_length=STRING.LENGTH("gcc_snoc_pcnoc_ahb_clk")

  if (STRING.SCAN("&clk", "*", 0)==0)
  (
    &wild_head=1
  )
  if (STRING.SCAN("&clk", "*", 1)==(STRING.LENGTH("&clk")-1))
  (
    &wild_tail=1
  )

  if ((&wild_head==1)&&(&wild_tail==1))
  (
    if (STRING.SCAN("gcc_snoc_pcnoc_ahb_clk", STRING.MID("&clk", 1, &clk_input_length-2), 0)!=-1)
    ( 
      &match=1
    )
  )
  else if (&wild_head==1)
  (
    if (STRING.MID("gcc_snoc_pcnoc_ahb_clk", &clk_itr_length-&clk_input_length+1, &clk_input_length-1)==STRING.CUT("&clk", 1))
    ( 
      &match=1
    )
  )
  else if (&wild_tail==1)
  (
    if (STRING.MID("gcc_snoc_pcnoc_ahb_clk", 0, &clk_input_length-1)==STRING.CUT("&clk", -1))
    ( 
      &match=1
    )
  )	  
  else if ("gcc_snoc_pcnoc_ahb_clk"=="&clk")
  (
    &match=1
  )
  
  if (&match==1)
  (
    &clk_test=&CLK_TEST_GCC_SNOC_PCNOC_AHB_CLK
    &clk_reg=&HWIO_GCC_SNOC_PCNOC_AHB_CBCR_ADDR
    &clk_reg_name="GCC_SNOC_PCNOC_AHB_CBCR"
    &clk_name="gcc_snoc_pcnoc_ahb_clk"
    &clk_reg_cbcr_type="sm_cbc"

    gosub Print_Clk_Info_Line
  )
  
  &match=0
  &wild_head=0
  &wild_tail=0
  &clk_input_length=STRING.LENGTH("&clk")
  &clk_itr_length=STRING.LENGTH("gcc_sys_noc_apss_ahb_clk")

  if (STRING.SCAN("&clk", "*", 0)==0)
  (
    &wild_head=1
  )
  if (STRING.SCAN("&clk", "*", 1)==(STRING.LENGTH("&clk")-1))
  (
    &wild_tail=1
  )

  if ((&wild_head==1)&&(&wild_tail==1))
  (
    if (STRING.SCAN("gcc_sys_noc_apss_ahb_clk", STRING.MID("&clk", 1, &clk_input_length-2), 0)!=-1)
    ( 
      &match=1
    )
  )
  else if (&wild_head==1)
  (
    if (STRING.MID("gcc_sys_noc_apss_ahb_clk", &clk_itr_length-&clk_input_length+1, &clk_input_length-1)==STRING.CUT("&clk", 1))
    ( 
      &match=1
    )
  )
  else if (&wild_tail==1)
  (
    if (STRING.MID("gcc_sys_noc_apss_ahb_clk", 0, &clk_input_length-1)==STRING.CUT("&clk", -1))
    ( 
      &match=1
    )
  )	  
  else if ("gcc_sys_noc_apss_ahb_clk"=="&clk")
  (
    &match=1
  )
  
  if (&match==1)
  (
    &clk_test=&CLK_TEST_GCC_SYS_NOC_APSS_AHB_CLK
    &clk_reg=&HWIO_GCC_SYS_NOC_APSS_AHB_CBCR_ADDR
    &clk_reg_name="GCC_SYS_NOC_APSS_AHB_CBCR"
    &clk_name="gcc_sys_noc_apss_ahb_clk"
    &clk_reg_cbcr_type="sm_cbc"

    gosub Print_Clk_Info_Line
  )
  
  &match=0
  &wild_head=0
  &wild_tail=0
  &clk_input_length=STRING.LENGTH("&clk")
  &clk_itr_length=STRING.LENGTH("gcc_sys_noc_at_clk")

  if (STRING.SCAN("&clk", "*", 0)==0)
  (
    &wild_head=1
  )
  if (STRING.SCAN("&clk", "*", 1)==(STRING.LENGTH("&clk")-1))
  (
    &wild_tail=1
  )

  if ((&wild_head==1)&&(&wild_tail==1))
  (
    if (STRING.SCAN("gcc_sys_noc_at_clk", STRING.MID("&clk", 1, &clk_input_length-2), 0)!=-1)
    ( 
      &match=1
    )
  )
  else if (&wild_head==1)
  (
    if (STRING.MID("gcc_sys_noc_at_clk", &clk_itr_length-&clk_input_length+1, &clk_input_length-1)==STRING.CUT("&clk", 1))
    ( 
      &match=1
    )
  )
  else if (&wild_tail==1)
  (
    if (STRING.MID("gcc_sys_noc_at_clk", 0, &clk_input_length-1)==STRING.CUT("&clk", -1))
    ( 
      &match=1
    )
  )	  
  else if ("gcc_sys_noc_at_clk"=="&clk")
  (
    &match=1
  )
  
  if (&match==1)
  (
    &clk_test=&CLK_TEST_GCC_SYS_NOC_AT_CLK
    &clk_reg=&HWIO_GCC_SYS_NOC_AT_CBCR_ADDR
    &clk_reg_name="GCC_SYS_NOC_AT_CBCR"
    &clk_name="gcc_sys_noc_at_clk"
    &clk_reg_cbcr_type="sm_cbc"

    gosub Print_Clk_Info_Line
  )
  
  &match=0
  &wild_head=0
  &wild_tail=0
  &clk_input_length=STRING.LENGTH("&clk")
  &clk_itr_length=STRING.LENGTH("gcc_sys_noc_axi_clk")

  if (STRING.SCAN("&clk", "*", 0)==0)
  (
    &wild_head=1
  )
  if (STRING.SCAN("&clk", "*", 1)==(STRING.LENGTH("&clk")-1))
  (
    &wild_tail=1
  )

  if ((&wild_head==1)&&(&wild_tail==1))
  (
    if (STRING.SCAN("gcc_sys_noc_axi_clk", STRING.MID("&clk", 1, &clk_input_length-2), 0)!=-1)
    ( 
      &match=1
    )
  )
  else if (&wild_head==1)
  (
    if (STRING.MID("gcc_sys_noc_axi_clk", &clk_itr_length-&clk_input_length+1, &clk_input_length-1)==STRING.CUT("&clk", 1))
    ( 
      &match=1
    )
  )
  else if (&wild_tail==1)
  (
    if (STRING.MID("gcc_sys_noc_axi_clk", 0, &clk_input_length-1)==STRING.CUT("&clk", -1))
    ( 
      &match=1
    )
  )	  
  else if ("gcc_sys_noc_axi_clk"=="&clk")
  (
    &match=1
  )
  
  ; This clock belongs to the 'buses' display group.
  if ("buses"=="&clk")
  (
    &match=1	  
  )
  
  if (&match==1)
  (
    &clk_test=&CLK_TEST_GCC_SYS_NOC_AXI_CLK
    &clk_reg=&HWIO_GCC_SYS_NOC_AXI_CBCR_ADDR
    &clk_reg_name="GCC_SYS_NOC_AXI_CBCR"
    &clk_name="gcc_sys_noc_axi_clk"
    &clk_reg_cbcr_type="sm_cbc"

    gosub Print_Clk_Info_Line
  )
  
  &match=0
  &wild_head=0
  &wild_tail=0
  &clk_input_length=STRING.LENGTH("&clk")
  &clk_itr_length=STRING.LENGTH("gcc_sys_noc_qdss_stm_axi_clk")

  if (STRING.SCAN("&clk", "*", 0)==0)
  (
    &wild_head=1
  )
  if (STRING.SCAN("&clk", "*", 1)==(STRING.LENGTH("&clk")-1))
  (
    &wild_tail=1
  )

  if ((&wild_head==1)&&(&wild_tail==1))
  (
    if (STRING.SCAN("gcc_sys_noc_qdss_stm_axi_clk", STRING.MID("&clk", 1, &clk_input_length-2), 0)!=-1)
    ( 
      &match=1
    )
  )
  else if (&wild_head==1)
  (
    if (STRING.MID("gcc_sys_noc_qdss_stm_axi_clk", &clk_itr_length-&clk_input_length+1, &clk_input_length-1)==STRING.CUT("&clk", 1))
    ( 
      &match=1
    )
  )
  else if (&wild_tail==1)
  (
    if (STRING.MID("gcc_sys_noc_qdss_stm_axi_clk", 0, &clk_input_length-1)==STRING.CUT("&clk", -1))
    ( 
      &match=1
    )
  )	  
  else if ("gcc_sys_noc_qdss_stm_axi_clk"=="&clk")
  (
    &match=1
  )
  
  if (&match==1)
  (
    &clk_test=&CLK_TEST_GCC_SYS_NOC_QDSS_STM_AXI_CLK
    &clk_reg=&HWIO_GCC_SYS_NOC_QDSS_STM_AXI_CBCR_ADDR
    &clk_reg_name="GCC_SYS_NOC_QDSS_STM_AXI_CBCR"
    &clk_name="gcc_sys_noc_qdss_stm_axi_clk"
    &clk_reg_cbcr_type="sm_cbc"

    gosub Print_Clk_Info_Line
  )
  
  &match=0
  &wild_head=0
  &wild_tail=0
  &clk_input_length=STRING.LENGTH("&clk")
  &clk_itr_length=STRING.LENGTH("gcc_tcsr_ahb_clk")

  if (STRING.SCAN("&clk", "*", 0)==0)
  (
    &wild_head=1
  )
  if (STRING.SCAN("&clk", "*", 1)==(STRING.LENGTH("&clk")-1))
  (
    &wild_tail=1
  )

  if ((&wild_head==1)&&(&wild_tail==1))
  (
    if (STRING.SCAN("gcc_tcsr_ahb_clk", STRING.MID("&clk", 1, &clk_input_length-2), 0)!=-1)
    ( 
      &match=1
    )
  )
  else if (&wild_head==1)
  (
    if (STRING.MID("gcc_tcsr_ahb_clk", &clk_itr_length-&clk_input_length+1, &clk_input_length-1)==STRING.CUT("&clk", 1))
    ( 
      &match=1
    )
  )
  else if (&wild_tail==1)
  (
    if (STRING.MID("gcc_tcsr_ahb_clk", 0, &clk_input_length-1)==STRING.CUT("&clk", -1))
    ( 
      &match=1
    )
  )	  
  else if ("gcc_tcsr_ahb_clk"=="&clk")
  (
    &match=1
  )
  
  if (&match==1)
  (
    &clk_test=&CLK_TEST_GCC_TCSR_AHB_CLK
    &clk_reg=&HWIO_GCC_TCSR_AHB_CBCR_ADDR
    &clk_reg_name="GCC_TCSR_AHB_CBCR"
    &clk_name="gcc_tcsr_ahb_clk"
    &clk_reg_cbcr_type="sm_cbc"

    gosub Print_Clk_Info_Line
  )
  
  &match=0
  &wild_head=0
  &wild_tail=0
  &clk_input_length=STRING.LENGTH("&clk")
  &clk_itr_length=STRING.LENGTH("gcc_tlmm_ahb_clk")

  if (STRING.SCAN("&clk", "*", 0)==0)
  (
    &wild_head=1
  )
  if (STRING.SCAN("&clk", "*", 1)==(STRING.LENGTH("&clk")-1))
  (
    &wild_tail=1
  )

  if ((&wild_head==1)&&(&wild_tail==1))
  (
    if (STRING.SCAN("gcc_tlmm_ahb_clk", STRING.MID("&clk", 1, &clk_input_length-2), 0)!=-1)
    ( 
      &match=1
    )
  )
  else if (&wild_head==1)
  (
    if (STRING.MID("gcc_tlmm_ahb_clk", &clk_itr_length-&clk_input_length+1, &clk_input_length-1)==STRING.CUT("&clk", 1))
    ( 
      &match=1
    )
  )
  else if (&wild_tail==1)
  (
    if (STRING.MID("gcc_tlmm_ahb_clk", 0, &clk_input_length-1)==STRING.CUT("&clk", -1))
    ( 
      &match=1
    )
  )	  
  else if ("gcc_tlmm_ahb_clk"=="&clk")
  (
    &match=1
  )
  
  if (&match==1)
  (
    &clk_test=&CLK_TEST_GCC_TLMM_AHB_CLK
    &clk_reg=&HWIO_GCC_TLMM_AHB_CBCR_ADDR
    &clk_reg_name="GCC_TLMM_AHB_CBCR"
    &clk_name="gcc_tlmm_ahb_clk"
    &clk_reg_cbcr_type="sm_cbc"

    gosub Print_Clk_Info_Line
  )
  
  &match=0
  &wild_head=0
  &wild_tail=0
  &clk_input_length=STRING.LENGTH("&clk")
  &clk_itr_length=STRING.LENGTH("gcc_tlmm_clk")

  if (STRING.SCAN("&clk", "*", 0)==0)
  (
    &wild_head=1
  )
  if (STRING.SCAN("&clk", "*", 1)==(STRING.LENGTH("&clk")-1))
  (
    &wild_tail=1
  )

  if ((&wild_head==1)&&(&wild_tail==1))
  (
    if (STRING.SCAN("gcc_tlmm_clk", STRING.MID("&clk", 1, &clk_input_length-2), 0)!=-1)
    ( 
      &match=1
    )
  )
  else if (&wild_head==1)
  (
    if (STRING.MID("gcc_tlmm_clk", &clk_itr_length-&clk_input_length+1, &clk_input_length-1)==STRING.CUT("&clk", 1))
    ( 
      &match=1
    )
  )
  else if (&wild_tail==1)
  (
    if (STRING.MID("gcc_tlmm_clk", 0, &clk_input_length-1)==STRING.CUT("&clk", -1))
    ( 
      &match=1
    )
  )	  
  else if ("gcc_tlmm_clk"=="&clk")
  (
    &match=1
  )
  
  if (&match==1)
  (
    &clk_test=&CLK_TEST_GCC_TLMM_CLK
    &clk_reg=&HWIO_GCC_TLMM_CBCR_ADDR
    &clk_reg_name="GCC_TLMM_CBCR"
    &clk_name="gcc_tlmm_clk"
    &clk_reg_cbcr_type="sm_cbc"

    gosub Print_Clk_Info_Line
  )
  
  &match=0
  &wild_head=0
  &wild_tail=0
  &clk_input_length=STRING.LENGTH("&clk")
  &clk_itr_length=STRING.LENGTH("gcc_ultaudio_lpaif_aux_i2s_clk")

  if (STRING.SCAN("&clk", "*", 0)==0)
  (
    &wild_head=1
  )
  if (STRING.SCAN("&clk", "*", 1)==(STRING.LENGTH("&clk")-1))
  (
    &wild_tail=1
  )

  if ((&wild_head==1)&&(&wild_tail==1))
  (
    if (STRING.SCAN("gcc_ultaudio_lpaif_aux_i2s_clk", STRING.MID("&clk", 1, &clk_input_length-2), 0)!=-1)
    ( 
      &match=1
    )
  )
  else if (&wild_head==1)
  (
    if (STRING.MID("gcc_ultaudio_lpaif_aux_i2s_clk", &clk_itr_length-&clk_input_length+1, &clk_input_length-1)==STRING.CUT("&clk", 1))
    ( 
      &match=1
    )
  )
  else if (&wild_tail==1)
  (
    if (STRING.MID("gcc_ultaudio_lpaif_aux_i2s_clk", 0, &clk_input_length-1)==STRING.CUT("&clk", -1))
    ( 
      &match=1
    )
  )	  
  else if ("gcc_ultaudio_lpaif_aux_i2s_clk"=="&clk")
  (
    &match=1
  )
  
  if (&match==1)
  (
    &clk_test=&CLK_TEST_GCC_ULTAUDIO_LPAIF_AUX_I2S_CLK
    &clk_reg=&HWIO_GCC_ULTAUDIO_LPAIF_AUX_I2S_CBCR_ADDR
    &clk_reg_name="GCC_ULTAUDIO_LPAIF_AUX_I2S_CBCR"
    &clk_name="gcc_ultaudio_lpaif_aux_i2s_clk"
    &clk_reg_cbcr_type="sm_cbc"

    gosub Print_Clk_Info_Line
  )
  
  &match=0
  &wild_head=0
  &wild_tail=0
  &clk_input_length=STRING.LENGTH("&clk")
  &clk_itr_length=STRING.LENGTH("gcc_ultaudio_ext_mclk2_clk")

  if (STRING.SCAN("&clk", "*", 0)==0)
  (
    &wild_head=1
  )
  if (STRING.SCAN("&clk", "*", 1)==(STRING.LENGTH("&clk")-1))
  (
    &wild_tail=1
  )

  if ((&wild_head==1)&&(&wild_tail==1))
  (
    if (STRING.SCAN("gcc_ultaudio_ext_mclk2_clk", STRING.MID("&clk", 1, &clk_input_length-2), 0)!=-1)
    ( 
      &match=1
    )
  )
  else if (&wild_head==1)
  (
    if (STRING.MID("gcc_ultaudio_ext_mclk2_clk", &clk_itr_length-&clk_input_length+1, &clk_input_length-1)==STRING.CUT("&clk", 1))
    ( 
      &match=1
    )
  )
  else if (&wild_tail==1)
  (
    if (STRING.MID("gcc_ultaudio_ext_mclk2_clk", 0, &clk_input_length-1)==STRING.CUT("&clk", -1))
    ( 
      &match=1
    )
  )	  
  else if ("gcc_ultaudio_ext_mclk2_clk"=="&clk")
  (
    &match=1
  )
  
  if (&match==1)
  (
    &clk_test=&CLK_TEST_GCC_ULTAUDIO_EXT_MCLK2_CLK
    &clk_reg=&HWIO_GCC_ULTAUDIO_EXT_MCLK2_CBCR_ADDR
    &clk_reg_name="GCC_ULTAUDIO_EXT_MCLK2_CBCR"
    &clk_name="gcc_ultaudio_ext_mclk2_clk"
    &clk_reg_cbcr_type="sm_cbc"

    gosub Print_Clk_Info_Line
  )
  
  &match=0
  &wild_head=0
  &wild_tail=0
  &clk_input_length=STRING.LENGTH("&clk")
  &clk_itr_length=STRING.LENGTH("gcc_ultaudio_pcm_data_oe_clk")

  if (STRING.SCAN("&clk", "*", 0)==0)
  (
    &wild_head=1
  )
  if (STRING.SCAN("&clk", "*", 1)==(STRING.LENGTH("&clk")-1))
  (
    &wild_tail=1
  )

  if ((&wild_head==1)&&(&wild_tail==1))
  (
    if (STRING.SCAN("gcc_ultaudio_pcm_data_oe_clk", STRING.MID("&clk", 1, &clk_input_length-2), 0)!=-1)
    ( 
      &match=1
    )
  )
  else if (&wild_head==1)
  (
    if (STRING.MID("gcc_ultaudio_pcm_data_oe_clk", &clk_itr_length-&clk_input_length+1, &clk_input_length-1)==STRING.CUT("&clk", 1))
    ( 
      &match=1
    )
  )
  else if (&wild_tail==1)
  (
    if (STRING.MID("gcc_ultaudio_pcm_data_oe_clk", 0, &clk_input_length-1)==STRING.CUT("&clk", -1))
    ( 
      &match=1
    )
  )	  
  else if ("gcc_ultaudio_pcm_data_oe_clk"=="&clk")
  (
    &match=1
  )
  
  if (&match==1)
  (
    &clk_test=&CLK_TEST_GCC_ULTAUDIO_PCM_DATA_OE_CLK
    &clk_reg=&HWIO_GCC_ULTAUDIO_PCM_DATA_OE_CBCR_ADDR
    &clk_reg_name="GCC_ULTAUDIO_PCM_DATA_OE_CBCR"
    &clk_name="gcc_ultaudio_pcm_data_oe_clk"
    &clk_reg_cbcr_type="sm_cbc"

    gosub Print_Clk_Info_Line
  )
  
  &match=0
  &wild_head=0
  &wild_tail=0
  &clk_input_length=STRING.LENGTH("&clk")
  &clk_itr_length=STRING.LENGTH("gcc_ultaudio_lpaif_pri_i2s_clk")

  if (STRING.SCAN("&clk", "*", 0)==0)
  (
    &wild_head=1
  )
  if (STRING.SCAN("&clk", "*", 1)==(STRING.LENGTH("&clk")-1))
  (
    &wild_tail=1
  )

  if ((&wild_head==1)&&(&wild_tail==1))
  (
    if (STRING.SCAN("gcc_ultaudio_lpaif_pri_i2s_clk", STRING.MID("&clk", 1, &clk_input_length-2), 0)!=-1)
    ( 
      &match=1
    )
  )
  else if (&wild_head==1)
  (
    if (STRING.MID("gcc_ultaudio_lpaif_pri_i2s_clk", &clk_itr_length-&clk_input_length+1, &clk_input_length-1)==STRING.CUT("&clk", 1))
    ( 
      &match=1
    )
  )
  else if (&wild_tail==1)
  (
    if (STRING.MID("gcc_ultaudio_lpaif_pri_i2s_clk", 0, &clk_input_length-1)==STRING.CUT("&clk", -1))
    ( 
      &match=1
    )
  )	  
  else if ("gcc_ultaudio_lpaif_pri_i2s_clk"=="&clk")
  (
    &match=1
  )
  
  if (&match==1)
  (
    &clk_test=&CLK_TEST_GCC_ULTAUDIO_LPAIF_PRI_I2S_CLK
    &clk_reg=&HWIO_GCC_ULTAUDIO_LPAIF_PRI_I2S_CBCR_ADDR
    &clk_reg_name="GCC_ULTAUDIO_LPAIF_PRI_I2S_CBCR"
    &clk_name="gcc_ultaudio_lpaif_pri_i2s_clk"
    &clk_reg_cbcr_type="sm_cbc"

    gosub Print_Clk_Info_Line
  )
  
  &match=0
  &wild_head=0
  &wild_tail=0
  &clk_input_length=STRING.LENGTH("&clk")
  &clk_itr_length=STRING.LENGTH("gcc_ultaudio_lpaif_sec_i2s_clk")

  if (STRING.SCAN("&clk", "*", 0)==0)
  (
    &wild_head=1
  )
  if (STRING.SCAN("&clk", "*", 1)==(STRING.LENGTH("&clk")-1))
  (
    &wild_tail=1
  )

  if ((&wild_head==1)&&(&wild_tail==1))
  (
    if (STRING.SCAN("gcc_ultaudio_lpaif_sec_i2s_clk", STRING.MID("&clk", 1, &clk_input_length-2), 0)!=-1)
    ( 
      &match=1
    )
  )
  else if (&wild_head==1)
  (
    if (STRING.MID("gcc_ultaudio_lpaif_sec_i2s_clk", &clk_itr_length-&clk_input_length+1, &clk_input_length-1)==STRING.CUT("&clk", 1))
    ( 
      &match=1
    )
  )
  else if (&wild_tail==1)
  (
    if (STRING.MID("gcc_ultaudio_lpaif_sec_i2s_clk", 0, &clk_input_length-1)==STRING.CUT("&clk", -1))
    ( 
      &match=1
    )
  )	  
  else if ("gcc_ultaudio_lpaif_sec_i2s_clk"=="&clk")
  (
    &match=1
  )
  
  if (&match==1)
  (
    &clk_test=&CLK_TEST_GCC_ULTAUDIO_LPAIF_SEC_I2S_CLK
    &clk_reg=&HWIO_GCC_ULTAUDIO_LPAIF_SEC_I2S_CBCR_ADDR
    &clk_reg_name="GCC_ULTAUDIO_LPAIF_SEC_I2S_CBCR"
    &clk_name="gcc_ultaudio_lpaif_sec_i2s_clk"
    &clk_reg_cbcr_type="sm_cbc"

    gosub Print_Clk_Info_Line
  )
  
  &match=0
  &wild_head=0
  &wild_tail=0
  &clk_input_length=STRING.LENGTH("&clk")
  &clk_itr_length=STRING.LENGTH("gcc_usb2a_phy_sleep_clk")

  if (STRING.SCAN("&clk", "*", 0)==0)
  (
    &wild_head=1
  )
  if (STRING.SCAN("&clk", "*", 1)==(STRING.LENGTH("&clk")-1))
  (
    &wild_tail=1
  )

  if ((&wild_head==1)&&(&wild_tail==1))
  (
    if (STRING.SCAN("gcc_usb2a_phy_sleep_clk", STRING.MID("&clk", 1, &clk_input_length-2), 0)!=-1)
    ( 
      &match=1
    )
  )
  else if (&wild_head==1)
  (
    if (STRING.MID("gcc_usb2a_phy_sleep_clk", &clk_itr_length-&clk_input_length+1, &clk_input_length-1)==STRING.CUT("&clk", 1))
    ( 
      &match=1
    )
  )
  else if (&wild_tail==1)
  (
    if (STRING.MID("gcc_usb2a_phy_sleep_clk", 0, &clk_input_length-1)==STRING.CUT("&clk", -1))
    ( 
      &match=1
    )
  )	  
  else if ("gcc_usb2a_phy_sleep_clk"=="&clk")
  (
    &match=1
  )
  
  if (&match==1)
  (
    &clk_test=&CLK_TEST_GCC_USB2A_PHY_SLEEP_CLK
    &clk_reg=&HWIO_GCC_USB2A_PHY_SLEEP_CBCR_ADDR
    &clk_reg_name="GCC_USB2A_PHY_SLEEP_CBCR"
    &clk_name="gcc_usb2a_phy_sleep_clk"
    &clk_reg_cbcr_type="sm_cbc"

    gosub Print_Clk_Info_Line
  )
  
  &match=0
  &wild_head=0
  &wild_tail=0
  &clk_input_length=STRING.LENGTH("&clk")
  &clk_itr_length=STRING.LENGTH("gcc_usb_hs_phy_cfg_ahb_clk")

  if (STRING.SCAN("&clk", "*", 0)==0)
  (
    &wild_head=1
  )
  if (STRING.SCAN("&clk", "*", 1)==(STRING.LENGTH("&clk")-1))
  (
    &wild_tail=1
  )

  if ((&wild_head==1)&&(&wild_tail==1))
  (
    if (STRING.SCAN("gcc_usb_hs_phy_cfg_ahb_clk", STRING.MID("&clk", 1, &clk_input_length-2), 0)!=-1)
    ( 
      &match=1
    )
  )
  else if (&wild_head==1)
  (
    if (STRING.MID("gcc_usb_hs_phy_cfg_ahb_clk", &clk_itr_length-&clk_input_length+1, &clk_input_length-1)==STRING.CUT("&clk", 1))
    ( 
      &match=1
    )
  )
  else if (&wild_tail==1)
  (
    if (STRING.MID("gcc_usb_hs_phy_cfg_ahb_clk", 0, &clk_input_length-1)==STRING.CUT("&clk", -1))
    ( 
      &match=1
    )
  )	  
  else if ("gcc_usb_hs_phy_cfg_ahb_clk"=="&clk")
  (
    &match=1
  )
  
  if (&match==1)
  (
    &clk_test=&CLK_TEST_GCC_USB_HS_PHY_CFG_AHB_CLK
    &clk_reg=&HWIO_GCC_USB_HS_PHY_CFG_AHB_CBCR_ADDR
    &clk_reg_name="GCC_USB_HS_PHY_CFG_AHB_CBCR"
    &clk_name="gcc_usb_hs_phy_cfg_ahb_clk"
    &clk_reg_cbcr_type="sm_cbc"

    gosub Print_Clk_Info_Line
  )
  
  &match=0
  &wild_head=0
  &wild_tail=0
  &clk_input_length=STRING.LENGTH("&clk")
  &clk_itr_length=STRING.LENGTH("gcc_usb_hs_ahb_clk")

  if (STRING.SCAN("&clk", "*", 0)==0)
  (
    &wild_head=1
  )
  if (STRING.SCAN("&clk", "*", 1)==(STRING.LENGTH("&clk")-1))
  (
    &wild_tail=1
  )

  if ((&wild_head==1)&&(&wild_tail==1))
  (
    if (STRING.SCAN("gcc_usb_hs_ahb_clk", STRING.MID("&clk", 1, &clk_input_length-2), 0)!=-1)
    ( 
      &match=1
    )
  )
  else if (&wild_head==1)
  (
    if (STRING.MID("gcc_usb_hs_ahb_clk", &clk_itr_length-&clk_input_length+1, &clk_input_length-1)==STRING.CUT("&clk", 1))
    ( 
      &match=1
    )
  )
  else if (&wild_tail==1)
  (
    if (STRING.MID("gcc_usb_hs_ahb_clk", 0, &clk_input_length-1)==STRING.CUT("&clk", -1))
    ( 
      &match=1
    )
  )	  
  else if ("gcc_usb_hs_ahb_clk"=="&clk")
  (
    &match=1
  )
  
  if (&match==1)
  (
    &clk_test=&CLK_TEST_GCC_USB_HS_AHB_CLK
    &clk_reg=&HWIO_GCC_USB_HS_AHB_CBCR_ADDR
    &clk_reg_name="GCC_USB_HS_AHB_CBCR"
    &clk_name="gcc_usb_hs_ahb_clk"
    &clk_reg_cbcr_type="sm_pscbc"

    gosub Print_Clk_Info_Line
  )
  
  &match=0
  &wild_head=0
  &wild_tail=0
  &clk_input_length=STRING.LENGTH("&clk")
  &clk_itr_length=STRING.LENGTH("gcc_usb_hs_inactivity_timers_clk")

  if (STRING.SCAN("&clk", "*", 0)==0)
  (
    &wild_head=1
  )
  if (STRING.SCAN("&clk", "*", 1)==(STRING.LENGTH("&clk")-1))
  (
    &wild_tail=1
  )

  if ((&wild_head==1)&&(&wild_tail==1))
  (
    if (STRING.SCAN("gcc_usb_hs_inactivity_timers_clk", STRING.MID("&clk", 1, &clk_input_length-2), 0)!=-1)
    ( 
      &match=1
    )
  )
  else if (&wild_head==1)
  (
    if (STRING.MID("gcc_usb_hs_inactivity_timers_clk", &clk_itr_length-&clk_input_length+1, &clk_input_length-1)==STRING.CUT("&clk", 1))
    ( 
      &match=1
    )
  )
  else if (&wild_tail==1)
  (
    if (STRING.MID("gcc_usb_hs_inactivity_timers_clk", 0, &clk_input_length-1)==STRING.CUT("&clk", -1))
    ( 
      &match=1
    )
  )	  
  else if ("gcc_usb_hs_inactivity_timers_clk"=="&clk")
  (
    &match=1
  )
  
  if (&match==1)
  (
    &clk_test=&CLK_TEST_GCC_USB_HS_INACTIVITY_TIMERS_CLK
    &clk_reg=&HWIO_GCC_USB_HS_INACTIVITY_TIMERS_CBCR_ADDR
    &clk_reg_name="GCC_USB_HS_INACTIVITY_TIMERS_CBCR"
    &clk_name="gcc_usb_hs_inactivity_timers_clk"
    &clk_reg_cbcr_type="sm_cbc"

    gosub Print_Clk_Info_Line
  )
  
  &match=0
  &wild_head=0
  &wild_tail=0
  &clk_input_length=STRING.LENGTH("&clk")
  &clk_itr_length=STRING.LENGTH("gcc_usb_hs_system_clk")

  if (STRING.SCAN("&clk", "*", 0)==0)
  (
    &wild_head=1
  )
  if (STRING.SCAN("&clk", "*", 1)==(STRING.LENGTH("&clk")-1))
  (
    &wild_tail=1
  )

  if ((&wild_head==1)&&(&wild_tail==1))
  (
    if (STRING.SCAN("gcc_usb_hs_system_clk", STRING.MID("&clk", 1, &clk_input_length-2), 0)!=-1)
    ( 
      &match=1
    )
  )
  else if (&wild_head==1)
  (
    if (STRING.MID("gcc_usb_hs_system_clk", &clk_itr_length-&clk_input_length+1, &clk_input_length-1)==STRING.CUT("&clk", 1))
    ( 
      &match=1
    )
  )
  else if (&wild_tail==1)
  (
    if (STRING.MID("gcc_usb_hs_system_clk", 0, &clk_input_length-1)==STRING.CUT("&clk", -1))
    ( 
      &match=1
    )
  )	  
  else if ("gcc_usb_hs_system_clk"=="&clk")
  (
    &match=1
  )
  
  if (&match==1)
  (
    &clk_test=&CLK_TEST_GCC_USB_HS_SYSTEM_CLK
    &clk_reg=&HWIO_GCC_USB_HS_SYSTEM_CBCR_ADDR
    &clk_reg_name="GCC_USB_HS_SYSTEM_CBCR"
    &clk_name="gcc_usb_hs_system_clk"
    &clk_reg_cbcr_type="sm_pscbc"

    gosub Print_Clk_Info_Line
  )
  
  &match=0
  &wild_head=0
  &wild_tail=0
  &clk_input_length=STRING.LENGTH("&clk")
  &clk_itr_length=STRING.LENGTH("gcc_venus0_ahb_clk")

  if (STRING.SCAN("&clk", "*", 0)==0)
  (
    &wild_head=1
  )
  if (STRING.SCAN("&clk", "*", 1)==(STRING.LENGTH("&clk")-1))
  (
    &wild_tail=1
  )

  if ((&wild_head==1)&&(&wild_tail==1))
  (
    if (STRING.SCAN("gcc_venus0_ahb_clk", STRING.MID("&clk", 1, &clk_input_length-2), 0)!=-1)
    ( 
      &match=1
    )
  )
  else if (&wild_head==1)
  (
    if (STRING.MID("gcc_venus0_ahb_clk", &clk_itr_length-&clk_input_length+1, &clk_input_length-1)==STRING.CUT("&clk", 1))
    ( 
      &match=1
    )
  )
  else if (&wild_tail==1)
  (
    if (STRING.MID("gcc_venus0_ahb_clk", 0, &clk_input_length-1)==STRING.CUT("&clk", -1))
    ( 
      &match=1
    )
  )	  
  else if ("gcc_venus0_ahb_clk"=="&clk")
  (
    &match=1
  )
  
  if (&match==1)
  (
    &clk_test=&CLK_TEST_GCC_VENUS0_AHB_CLK
    &clk_reg=&HWIO_GCC_VENUS0_AHB_CBCR_ADDR
    &clk_reg_name="GCC_VENUS0_AHB_CBCR"
    &clk_name="gcc_venus0_ahb_clk"
    &clk_reg_cbcr_type="sm_cbc"

    gosub Print_Clk_Info_Line
  )
  
  &match=0
  &wild_head=0
  &wild_tail=0
  &clk_input_length=STRING.LENGTH("&clk")
  &clk_itr_length=STRING.LENGTH("gcc_venus0_axi_clk")

  if (STRING.SCAN("&clk", "*", 0)==0)
  (
    &wild_head=1
  )
  if (STRING.SCAN("&clk", "*", 1)==(STRING.LENGTH("&clk")-1))
  (
    &wild_tail=1
  )

  if ((&wild_head==1)&&(&wild_tail==1))
  (
    if (STRING.SCAN("gcc_venus0_axi_clk", STRING.MID("&clk", 1, &clk_input_length-2), 0)!=-1)
    ( 
      &match=1
    )
  )
  else if (&wild_head==1)
  (
    if (STRING.MID("gcc_venus0_axi_clk", &clk_itr_length-&clk_input_length+1, &clk_input_length-1)==STRING.CUT("&clk", 1))
    ( 
      &match=1
    )
  )
  else if (&wild_tail==1)
  (
    if (STRING.MID("gcc_venus0_axi_clk", 0, &clk_input_length-1)==STRING.CUT("&clk", -1))
    ( 
      &match=1
    )
  )	  
  else if ("gcc_venus0_axi_clk"=="&clk")
  (
    &match=1
  )
  
  if (&match==1)
  (
    &clk_test=&CLK_TEST_GCC_VENUS0_AXI_CLK
    &clk_reg=&HWIO_GCC_VENUS0_AXI_CBCR_ADDR
    &clk_reg_name="GCC_VENUS0_AXI_CBCR"
    &clk_name="gcc_venus0_axi_clk"
    &clk_reg_cbcr_type="sm_pscbc"

    gosub Print_Clk_Info_Line
  )
  
  &match=0
  &wild_head=0
  &wild_tail=0
  &clk_input_length=STRING.LENGTH("&clk")
  &clk_itr_length=STRING.LENGTH("gcc_venus0_core0_vcodec0_clk")

  if (STRING.SCAN("&clk", "*", 0)==0)
  (
    &wild_head=1
  )
  if (STRING.SCAN("&clk", "*", 1)==(STRING.LENGTH("&clk")-1))
  (
    &wild_tail=1
  )

  if ((&wild_head==1)&&(&wild_tail==1))
  (
    if (STRING.SCAN("gcc_venus0_core0_vcodec0_clk", STRING.MID("&clk", 1, &clk_input_length-2), 0)!=-1)
    ( 
      &match=1
    )
  )
  else if (&wild_head==1)
  (
    if (STRING.MID("gcc_venus0_core0_vcodec0_clk", &clk_itr_length-&clk_input_length+1, &clk_input_length-1)==STRING.CUT("&clk", 1))
    ( 
      &match=1
    )
  )
  else if (&wild_tail==1)
  (
    if (STRING.MID("gcc_venus0_core0_vcodec0_clk", 0, &clk_input_length-1)==STRING.CUT("&clk", -1))
    ( 
      &match=1
    )
  )	  
  else if ("gcc_venus0_core0_vcodec0_clk"=="&clk")
  (
    &match=1
  )
  
  if (&match==1)
  (
    &clk_test=&CLK_TEST_GCC_VENUS0_CORE0_VCODEC0_CLK
    &clk_reg=&HWIO_GCC_VENUS0_CORE0_VCODEC0_CBCR_ADDR
    &clk_reg_name="GCC_VENUS0_CORE0_VCODEC0_CBCR"
    &clk_name="gcc_venus0_core0_vcodec0_clk"
    &clk_reg_cbcr_type="sm_pscbc"

    gosub Print_Clk_Info_Line
  )
  
  &match=0
  &wild_head=0
  &wild_tail=0
  &clk_input_length=STRING.LENGTH("&clk")
  &clk_itr_length=STRING.LENGTH("gcc_venus0_qdss_apb_clk")

  if (STRING.SCAN("&clk", "*", 0)==0)
  (
    &wild_head=1
  )
  if (STRING.SCAN("&clk", "*", 1)==(STRING.LENGTH("&clk")-1))
  (
    &wild_tail=1
  )

  if ((&wild_head==1)&&(&wild_tail==1))
  (
    if (STRING.SCAN("gcc_venus0_qdss_apb_clk", STRING.MID("&clk", 1, &clk_input_length-2), 0)!=-1)
    ( 
      &match=1
    )
  )
  else if (&wild_head==1)
  (
    if (STRING.MID("gcc_venus0_qdss_apb_clk", &clk_itr_length-&clk_input_length+1, &clk_input_length-1)==STRING.CUT("&clk", 1))
    ( 
      &match=1
    )
  )
  else if (&wild_tail==1)
  (
    if (STRING.MID("gcc_venus0_qdss_apb_clk", 0, &clk_input_length-1)==STRING.CUT("&clk", -1))
    ( 
      &match=1
    )
  )	  
  else if ("gcc_venus0_qdss_apb_clk"=="&clk")
  (
    &match=1
  )
  
  if (&match==1)
  (
    &clk_test=&CLK_TEST_GCC_VENUS0_QDSS_APB_CLK
    &clk_reg=0
    &clk_reg_name="No CBCR"
    &clk_name="gcc_venus0_qdss_apb_clk"
    &clk_reg_cbcr_type="ACGC"

    gosub Print_Clk_Info_Line
  )
  
  &match=0
  &wild_head=0
  &wild_tail=0
  &clk_input_length=STRING.LENGTH("&clk")
  &clk_itr_length=STRING.LENGTH("gcc_venus0_qdss_at_clk")

  if (STRING.SCAN("&clk", "*", 0)==0)
  (
    &wild_head=1
  )
  if (STRING.SCAN("&clk", "*", 1)==(STRING.LENGTH("&clk")-1))
  (
    &wild_tail=1
  )

  if ((&wild_head==1)&&(&wild_tail==1))
  (
    if (STRING.SCAN("gcc_venus0_qdss_at_clk", STRING.MID("&clk", 1, &clk_input_length-2), 0)!=-1)
    ( 
      &match=1
    )
  )
  else if (&wild_head==1)
  (
    if (STRING.MID("gcc_venus0_qdss_at_clk", &clk_itr_length-&clk_input_length+1, &clk_input_length-1)==STRING.CUT("&clk", 1))
    ( 
      &match=1
    )
  )
  else if (&wild_tail==1)
  (
    if (STRING.MID("gcc_venus0_qdss_at_clk", 0, &clk_input_length-1)==STRING.CUT("&clk", -1))
    ( 
      &match=1
    )
  )	  
  else if ("gcc_venus0_qdss_at_clk"=="&clk")
  (
    &match=1
  )
  
  if (&match==1)
  (
    &clk_test=&CLK_TEST_GCC_VENUS0_QDSS_AT_CLK
    &clk_reg=0
    &clk_reg_name="No CBCR"
    &clk_name="gcc_venus0_qdss_at_clk"
    &clk_reg_cbcr_type="cgc"

    gosub Print_Clk_Info_Line
  )
  
  &match=0
  &wild_head=0
  &wild_tail=0
  &clk_input_length=STRING.LENGTH("&clk")
  &clk_itr_length=STRING.LENGTH("gcc_venus0_qdss_tsctr_div8_clk")

  if (STRING.SCAN("&clk", "*", 0)==0)
  (
    &wild_head=1
  )
  if (STRING.SCAN("&clk", "*", 1)==(STRING.LENGTH("&clk")-1))
  (
    &wild_tail=1
  )

  if ((&wild_head==1)&&(&wild_tail==1))
  (
    if (STRING.SCAN("gcc_venus0_qdss_tsctr_div8_clk", STRING.MID("&clk", 1, &clk_input_length-2), 0)!=-1)
    ( 
      &match=1
    )
  )
  else if (&wild_head==1)
  (
    if (STRING.MID("gcc_venus0_qdss_tsctr_div8_clk", &clk_itr_length-&clk_input_length+1, &clk_input_length-1)==STRING.CUT("&clk", 1))
    ( 
      &match=1
    )
  )
  else if (&wild_tail==1)
  (
    if (STRING.MID("gcc_venus0_qdss_tsctr_div8_clk", 0, &clk_input_length-1)==STRING.CUT("&clk", -1))
    ( 
      &match=1
    )
  )	  
  else if ("gcc_venus0_qdss_tsctr_div8_clk"=="&clk")
  (
    &match=1
  )
  
  if (&match==1)
  (
    &clk_test=&CLK_TEST_GCC_VENUS0_QDSS_TSCTR_DIV8_CLK
    &clk_reg=0
    &clk_reg_name="No CBCR"
    &clk_name="gcc_venus0_qdss_tsctr_div8_clk"
    &clk_reg_cbcr_type="cgc"

    gosub Print_Clk_Info_Line
  )
  
  &match=0
  &wild_head=0
  &wild_tail=0
  &clk_input_length=STRING.LENGTH("&clk")
  &clk_itr_length=STRING.LENGTH("gcc_venus0_vcodec0_clk")

  if (STRING.SCAN("&clk", "*", 0)==0)
  (
    &wild_head=1
  )
  if (STRING.SCAN("&clk", "*", 1)==(STRING.LENGTH("&clk")-1))
  (
    &wild_tail=1
  )

  if ((&wild_head==1)&&(&wild_tail==1))
  (
    if (STRING.SCAN("gcc_venus0_vcodec0_clk", STRING.MID("&clk", 1, &clk_input_length-2), 0)!=-1)
    ( 
      &match=1
    )
  )
  else if (&wild_head==1)
  (
    if (STRING.MID("gcc_venus0_vcodec0_clk", &clk_itr_length-&clk_input_length+1, &clk_input_length-1)==STRING.CUT("&clk", 1))
    ( 
      &match=1
    )
  )
  else if (&wild_tail==1)
  (
    if (STRING.MID("gcc_venus0_vcodec0_clk", 0, &clk_input_length-1)==STRING.CUT("&clk", -1))
    ( 
      &match=1
    )
  )	  
  else if ("gcc_venus0_vcodec0_clk"=="&clk")
  (
    &match=1
  )
  
  if (&match==1)
  (
    &clk_test=&CLK_TEST_GCC_VENUS0_VCODEC0_CLK
    &clk_reg=&HWIO_GCC_VENUS0_VCODEC0_CBCR_ADDR
    &clk_reg_name="GCC_VENUS0_VCODEC0_CBCR"
    &clk_name="gcc_venus0_vcodec0_clk"
    &clk_reg_cbcr_type="sm_pscbc"

    gosub Print_Clk_Info_Line
  )
  
  &match=0
  &wild_head=0
  &wild_tail=0
  &clk_input_length=STRING.LENGTH("&clk")
  &clk_itr_length=STRING.LENGTH("gcc_pcnoc_mpu_cfg_ahb_clk")

  if (STRING.SCAN("&clk", "*", 0)==0)
  (
    &wild_head=1
  )
  if (STRING.SCAN("&clk", "*", 1)==(STRING.LENGTH("&clk")-1))
  (
    &wild_tail=1
  )

  if ((&wild_head==1)&&(&wild_tail==1))
  (
    if (STRING.SCAN("gcc_pcnoc_mpu_cfg_ahb_clk", STRING.MID("&clk", 1, &clk_input_length-2), 0)!=-1)
    ( 
      &match=1
    )
  )
  else if (&wild_head==1)
  (
    if (STRING.MID("gcc_pcnoc_mpu_cfg_ahb_clk", &clk_itr_length-&clk_input_length+1, &clk_input_length-1)==STRING.CUT("&clk", 1))
    ( 
      &match=1
    )
  )
  else if (&wild_tail==1)
  (
    if (STRING.MID("gcc_pcnoc_mpu_cfg_ahb_clk", 0, &clk_input_length-1)==STRING.CUT("&clk", -1))
    ( 
      &match=1
    )
  )	  
  else if ("gcc_pcnoc_mpu_cfg_ahb_clk"=="&clk")
  (
    &match=1
  )
  
  if (&match==1)
  (
    &clk_test=&CLK_TEST_GCC_PCNOC_MPU_CFG_AHB_CLK
    &clk_reg=&HWIO_GCC_PCNOC_MPU_CFG_AHB_CBCR_ADDR
    &clk_reg_name="GCC_PCNOC_MPU_CFG_AHB_CBCR"
    &clk_name="gcc_pcnoc_mpu_cfg_ahb_clk"
    &clk_reg_cbcr_type="sm_cbc"

    gosub Print_Clk_Info_Line
  )
  
  &match=0
  &wild_head=0
  &wild_tail=0
  &clk_input_length=STRING.LENGTH("&clk")
  &clk_itr_length=STRING.LENGTH("gcc_prng_xpu_cfg_ahb_clk")

  if (STRING.SCAN("&clk", "*", 0)==0)
  (
    &wild_head=1
  )
  if (STRING.SCAN("&clk", "*", 1)==(STRING.LENGTH("&clk")-1))
  (
    &wild_tail=1
  )

  if ((&wild_head==1)&&(&wild_tail==1))
  (
    if (STRING.SCAN("gcc_prng_xpu_cfg_ahb_clk", STRING.MID("&clk", 1, &clk_input_length-2), 0)!=-1)
    ( 
      &match=1
    )
  )
  else if (&wild_head==1)
  (
    if (STRING.MID("gcc_prng_xpu_cfg_ahb_clk", &clk_itr_length-&clk_input_length+1, &clk_input_length-1)==STRING.CUT("&clk", 1))
    ( 
      &match=1
    )
  )
  else if (&wild_tail==1)
  (
    if (STRING.MID("gcc_prng_xpu_cfg_ahb_clk", 0, &clk_input_length-1)==STRING.CUT("&clk", -1))
    ( 
      &match=1
    )
  )	  
  else if ("gcc_prng_xpu_cfg_ahb_clk"=="&clk")
  (
    &match=1
  )
  
  if (&match==1)
  (
    &clk_test=&CLK_TEST_GCC_PRNG_XPU_CFG_AHB_CLK
    &clk_reg=&HWIO_GCC_PRNG_XPU_CFG_AHB_CBCR_ADDR
    &clk_reg_name="GCC_PRNG_XPU_CFG_AHB_CBCR"
    &clk_name="gcc_prng_xpu_cfg_ahb_clk"
    &clk_reg_cbcr_type="sm_cbc"

    gosub Print_Clk_Info_Line
  )
  
; Setting appropriate access mode for non-MSS clocks
&clk_access_mod="a:"

  &match=0
  &wild_head=0
  &wild_tail=0
  &clk_input_length=STRING.LENGTH("&clk")
  &clk_itr_length=STRING.LENGTH("wcss_bt_32m_clk_src")

  if (STRING.SCAN("&clk", "*", 0)==0)
  (
    &wild_head=1
  )
  if (STRING.SCAN("&clk", "*", 1)==(STRING.LENGTH("&clk")-1))
  (
    &wild_tail=1
  )

  if ((&wild_head==1)&&(&wild_tail==1))
  (
    if (STRING.SCAN("wcss_bt_32m_clk_src", STRING.MID("&clk", 1, &clk_input_length-2), 0)!=-1)
    ( 
      &match=1
    )
  )
  else if (&wild_head==1)
  (
    if (STRING.MID("wcss_bt_32m_clk_src", &clk_itr_length-&clk_input_length+1, &clk_input_length-1)==STRING.CUT("&clk", 1))
    ( 
      &match=1
    )
  )
  else if (&wild_tail==1)
  (
    if (STRING.MID("wcss_bt_32m_clk_src", 0, &clk_input_length-1)==STRING.CUT("&clk", -1))
    ( 
      &match=1
    )
  )	  
  else if ("wcss_bt_32m_clk_src"=="&clk")
  (
    &match=1
  )
  
  if (&match==1)
  (
    &clk_test=&CLK_TEST_WCSS_BT_32M_CLK_SRC
    &clk_reg=0
    &clk_reg_name="No CBCR"
    &clk_name="wcss_bt_32m_clk_src"
    &clk_reg_cbcr_type=""

    gosub Print_Clk_Info_Line
  )
  
  &match=0
  &wild_head=0
  &wild_tail=0
  &clk_input_length=STRING.LENGTH("&clk")
  &clk_itr_length=STRING.LENGTH("wcss_bt_fm_19m_clk_src")

  if (STRING.SCAN("&clk", "*", 0)==0)
  (
    &wild_head=1
  )
  if (STRING.SCAN("&clk", "*", 1)==(STRING.LENGTH("&clk")-1))
  (
    &wild_tail=1
  )

  if ((&wild_head==1)&&(&wild_tail==1))
  (
    if (STRING.SCAN("wcss_bt_fm_19m_clk_src", STRING.MID("&clk", 1, &clk_input_length-2), 0)!=-1)
    ( 
      &match=1
    )
  )
  else if (&wild_head==1)
  (
    if (STRING.MID("wcss_bt_fm_19m_clk_src", &clk_itr_length-&clk_input_length+1, &clk_input_length-1)==STRING.CUT("&clk", 1))
    ( 
      &match=1
    )
  )
  else if (&wild_tail==1)
  (
    if (STRING.MID("wcss_bt_fm_19m_clk_src", 0, &clk_input_length-1)==STRING.CUT("&clk", -1))
    ( 
      &match=1
    )
  )	  
  else if ("wcss_bt_fm_19m_clk_src"=="&clk")
  (
    &match=1
  )
  
  if (&match==1)
  (
    &clk_test=&CLK_TEST_WCSS_BT_FM_19M_CLK_SRC
    &clk_reg=0
    &clk_reg_name="No CBCR"
    &clk_name="wcss_bt_fm_19m_clk_src"
    &clk_reg_cbcr_type=""

    gosub Print_Clk_Info_Line
  )
  
  &match=0
  &wild_head=0
  &wild_tail=0
  &clk_input_length=STRING.LENGTH("&clk")
  &clk_itr_length=STRING.LENGTH("wcss_common_ahb_clk")

  if (STRING.SCAN("&clk", "*", 0)==0)
  (
    &wild_head=1
  )
  if (STRING.SCAN("&clk", "*", 1)==(STRING.LENGTH("&clk")-1))
  (
    &wild_tail=1
  )

  if ((&wild_head==1)&&(&wild_tail==1))
  (
    if (STRING.SCAN("wcss_common_ahb_clk", STRING.MID("&clk", 1, &clk_input_length-2), 0)!=-1)
    ( 
      &match=1
    )
  )
  else if (&wild_head==1)
  (
    if (STRING.MID("wcss_common_ahb_clk", &clk_itr_length-&clk_input_length+1, &clk_input_length-1)==STRING.CUT("&clk", 1))
    ( 
      &match=1
    )
  )
  else if (&wild_tail==1)
  (
    if (STRING.MID("wcss_common_ahb_clk", 0, &clk_input_length-1)==STRING.CUT("&clk", -1))
    ( 
      &match=1
    )
  )	  
  else if ("wcss_common_ahb_clk"=="&clk")
  (
    &match=1
  )
  
  if (&match==1)
  (
    &clk_test=&CLK_TEST_WCSS_COMMON_AHB_CLK
    &clk_reg=&HWIO_WCSS_A_PMU_COMMON_AHB_CBCR_ADDR
    &clk_reg_name="WCSS_A_PMU_COMMON_AHB_CBCR"
    &clk_name="wcss_common_ahb_clk"
    &clk_reg_cbcr_type="sm_pscbc"

    gosub Print_Clk_Info_Line
  )
  
  &match=0
  &wild_head=0
  &wild_tail=0
  &clk_input_length=STRING.LENGTH("&clk")
  &clk_itr_length=STRING.LENGTH("wcss_common_bt_32m_clk")

  if (STRING.SCAN("&clk", "*", 0)==0)
  (
    &wild_head=1
  )
  if (STRING.SCAN("&clk", "*", 1)==(STRING.LENGTH("&clk")-1))
  (
    &wild_tail=1
  )

  if ((&wild_head==1)&&(&wild_tail==1))
  (
    if (STRING.SCAN("wcss_common_bt_32m_clk", STRING.MID("&clk", 1, &clk_input_length-2), 0)!=-1)
    ( 
      &match=1
    )
  )
  else if (&wild_head==1)
  (
    if (STRING.MID("wcss_common_bt_32m_clk", &clk_itr_length-&clk_input_length+1, &clk_input_length-1)==STRING.CUT("&clk", 1))
    ( 
      &match=1
    )
  )
  else if (&wild_tail==1)
  (
    if (STRING.MID("wcss_common_bt_32m_clk", 0, &clk_input_length-1)==STRING.CUT("&clk", -1))
    ( 
      &match=1
    )
  )	  
  else if ("wcss_common_bt_32m_clk"=="&clk")
  (
    &match=1
  )
  
  if (&match==1)
  (
    &clk_test=&CLK_TEST_WCSS_COMMON_BT_32M_CLK
    &clk_reg=&HWIO_WCSS_A_PMU_COMMON_BT_32M_CBCR_ADDR
    &clk_reg_name="WCSS_A_PMU_COMMON_BT_32M_CBCR"
    &clk_name="wcss_common_bt_32m_clk"
    &clk_reg_cbcr_type="sm_cbc"

    gosub Print_Clk_Info_Line
  )
  
  &match=0
  &wild_head=0
  &wild_tail=0
  &clk_input_length=STRING.LENGTH("&clk")
  &clk_itr_length=STRING.LENGTH("wcss_common_bt_fm_19m_clk")

  if (STRING.SCAN("&clk", "*", 0)==0)
  (
    &wild_head=1
  )
  if (STRING.SCAN("&clk", "*", 1)==(STRING.LENGTH("&clk")-1))
  (
    &wild_tail=1
  )

  if ((&wild_head==1)&&(&wild_tail==1))
  (
    if (STRING.SCAN("wcss_common_bt_fm_19m_clk", STRING.MID("&clk", 1, &clk_input_length-2), 0)!=-1)
    ( 
      &match=1
    )
  )
  else if (&wild_head==1)
  (
    if (STRING.MID("wcss_common_bt_fm_19m_clk", &clk_itr_length-&clk_input_length+1, &clk_input_length-1)==STRING.CUT("&clk", 1))
    ( 
      &match=1
    )
  )
  else if (&wild_tail==1)
  (
    if (STRING.MID("wcss_common_bt_fm_19m_clk", 0, &clk_input_length-1)==STRING.CUT("&clk", -1))
    ( 
      &match=1
    )
  )	  
  else if ("wcss_common_bt_fm_19m_clk"=="&clk")
  (
    &match=1
  )
  
  if (&match==1)
  (
    &clk_test=&CLK_TEST_WCSS_COMMON_BT_FM_19M_CLK
    &clk_reg=&HWIO_WCSS_A_PMU_COMMON_BT_FM_19M_CBCR_ADDR
    &clk_reg_name="WCSS_A_PMU_COMMON_BT_FM_19M_CBCR"
    &clk_name="wcss_common_bt_fm_19m_clk"
    &clk_reg_cbcr_type="sm_cbc"

    gosub Print_Clk_Info_Line
  )
  
  &match=0
  &wild_head=0
  &wild_tail=0
  &clk_input_length=STRING.LENGTH("&clk")
  &clk_itr_length=STRING.LENGTH("wcss_common_cpu_clk")

  if (STRING.SCAN("&clk", "*", 0)==0)
  (
    &wild_head=1
  )
  if (STRING.SCAN("&clk", "*", 1)==(STRING.LENGTH("&clk")-1))
  (
    &wild_tail=1
  )

  if ((&wild_head==1)&&(&wild_tail==1))
  (
    if (STRING.SCAN("wcss_common_cpu_clk", STRING.MID("&clk", 1, &clk_input_length-2), 0)!=-1)
    ( 
      &match=1
    )
  )
  else if (&wild_head==1)
  (
    if (STRING.MID("wcss_common_cpu_clk", &clk_itr_length-&clk_input_length+1, &clk_input_length-1)==STRING.CUT("&clk", 1))
    ( 
      &match=1
    )
  )
  else if (&wild_tail==1)
  (
    if (STRING.MID("wcss_common_cpu_clk", 0, &clk_input_length-1)==STRING.CUT("&clk", -1))
    ( 
      &match=1
    )
  )	  
  else if ("wcss_common_cpu_clk"=="&clk")
  (
    &match=1
  )
  
  ; This clock belongs to the 'cpus' display group.
  if ("cpus"=="&clk")
  (
    &match=1	  
  )
  
  if (&match==1)
  (
    &clk_test=&CLK_TEST_WCSS_COMMON_CPU_CLK
    &clk_reg=&HWIO_WCSS_A_PMU_COMMON_CPU_CBCR_ADDR
    &clk_reg_name="WCSS_A_PMU_COMMON_CPU_CBCR"
    &clk_name="wcss_common_cpu_clk"
    &clk_reg_cbcr_type="sm_pscbc"

    gosub Print_Clk_Info_Line
  )
  
  &match=0
  &wild_head=0
  &wild_tail=0
  &clk_input_length=STRING.LENGTH("&clk")
  &clk_itr_length=STRING.LENGTH("wcss_common_phy_dbg_clk")

  if (STRING.SCAN("&clk", "*", 0)==0)
  (
    &wild_head=1
  )
  if (STRING.SCAN("&clk", "*", 1)==(STRING.LENGTH("&clk")-1))
  (
    &wild_tail=1
  )

  if ((&wild_head==1)&&(&wild_tail==1))
  (
    if (STRING.SCAN("wcss_common_phy_dbg_clk", STRING.MID("&clk", 1, &clk_input_length-2), 0)!=-1)
    ( 
      &match=1
    )
  )
  else if (&wild_head==1)
  (
    if (STRING.MID("wcss_common_phy_dbg_clk", &clk_itr_length-&clk_input_length+1, &clk_input_length-1)==STRING.CUT("&clk", 1))
    ( 
      &match=1
    )
  )
  else if (&wild_tail==1)
  (
    if (STRING.MID("wcss_common_phy_dbg_clk", 0, &clk_input_length-1)==STRING.CUT("&clk", -1))
    ( 
      &match=1
    )
  )	  
  else if ("wcss_common_phy_dbg_clk"=="&clk")
  (
    &match=1
  )
  
  if (&match==1)
  (
    &clk_test=&CLK_TEST_WCSS_COMMON_PHY_DBG_CLK
    &clk_reg=&HWIO_WCSS_A_PMU_COMMON_PHY_DBG_CBCR_ADDR
    &clk_reg_name="WCSS_A_PMU_COMMON_PHY_DBG_CBCR"
    &clk_name="wcss_common_phy_dbg_clk"
    &clk_reg_cbcr_type="sm_cbc"

    gosub Print_Clk_Info_Line
  )
  
  &match=0
  &wild_head=0
  &wild_tail=0
  &clk_input_length=STRING.LENGTH("&clk")
  &clk_itr_length=STRING.LENGTH("wcss_common_slp_clk")

  if (STRING.SCAN("&clk", "*", 0)==0)
  (
    &wild_head=1
  )
  if (STRING.SCAN("&clk", "*", 1)==(STRING.LENGTH("&clk")-1))
  (
    &wild_tail=1
  )

  if ((&wild_head==1)&&(&wild_tail==1))
  (
    if (STRING.SCAN("wcss_common_slp_clk", STRING.MID("&clk", 1, &clk_input_length-2), 0)!=-1)
    ( 
      &match=1
    )
  )
  else if (&wild_head==1)
  (
    if (STRING.MID("wcss_common_slp_clk", &clk_itr_length-&clk_input_length+1, &clk_input_length-1)==STRING.CUT("&clk", 1))
    ( 
      &match=1
    )
  )
  else if (&wild_tail==1)
  (
    if (STRING.MID("wcss_common_slp_clk", 0, &clk_input_length-1)==STRING.CUT("&clk", -1))
    ( 
      &match=1
    )
  )	  
  else if ("wcss_common_slp_clk"=="&clk")
  (
    &match=1
  )
  
  if (&match==1)
  (
    &clk_test=&CLK_TEST_WCSS_COMMON_SLP_CLK
    &clk_reg=&HWIO_WCSS_A_PMU_COMMON_SLP_CBCR_ADDR
    &clk_reg_name="WCSS_A_PMU_COMMON_SLP_CBCR"
    &clk_name="wcss_common_slp_clk"
    &clk_reg_cbcr_type="sm_cbc"

    gosub Print_Clk_Info_Line
  )
  
  &match=0
  &wild_head=0
  &wild_tail=0
  &clk_input_length=STRING.LENGTH("&clk")
  &clk_itr_length=STRING.LENGTH("wcss_common_trc_clk")

  if (STRING.SCAN("&clk", "*", 0)==0)
  (
    &wild_head=1
  )
  if (STRING.SCAN("&clk", "*", 1)==(STRING.LENGTH("&clk")-1))
  (
    &wild_tail=1
  )

  if ((&wild_head==1)&&(&wild_tail==1))
  (
    if (STRING.SCAN("wcss_common_trc_clk", STRING.MID("&clk", 1, &clk_input_length-2), 0)!=-1)
    ( 
      &match=1
    )
  )
  else if (&wild_head==1)
  (
    if (STRING.MID("wcss_common_trc_clk", &clk_itr_length-&clk_input_length+1, &clk_input_length-1)==STRING.CUT("&clk", 1))
    ( 
      &match=1
    )
  )
  else if (&wild_tail==1)
  (
    if (STRING.MID("wcss_common_trc_clk", 0, &clk_input_length-1)==STRING.CUT("&clk", -1))
    ( 
      &match=1
    )
  )	  
  else if ("wcss_common_trc_clk"=="&clk")
  (
    &match=1
  )
  
  if (&match==1)
  (
    &clk_test=&CLK_TEST_WCSS_COMMON_TRC_CLK
    &clk_reg=&HWIO_WCSS_A_PMU_COMMON_TRC_CBCR_ADDR
    &clk_reg_name="WCSS_A_PMU_COMMON_TRC_CBCR"
    &clk_name="wcss_common_trc_clk"
    &clk_reg_cbcr_type="sm_cbc"

    gosub Print_Clk_Info_Line
  )
  
  &match=0
  &wild_head=0
  &wild_tail=0
  &clk_input_length=STRING.LENGTH("&clk")
  &clk_itr_length=STRING.LENGTH("wcss_common_xo_clk")

  if (STRING.SCAN("&clk", "*", 0)==0)
  (
    &wild_head=1
  )
  if (STRING.SCAN("&clk", "*", 1)==(STRING.LENGTH("&clk")-1))
  (
    &wild_tail=1
  )

  if ((&wild_head==1)&&(&wild_tail==1))
  (
    if (STRING.SCAN("wcss_common_xo_clk", STRING.MID("&clk", 1, &clk_input_length-2), 0)!=-1)
    ( 
      &match=1
    )
  )
  else if (&wild_head==1)
  (
    if (STRING.MID("wcss_common_xo_clk", &clk_itr_length-&clk_input_length+1, &clk_input_length-1)==STRING.CUT("&clk", 1))
    ( 
      &match=1
    )
  )
  else if (&wild_tail==1)
  (
    if (STRING.MID("wcss_common_xo_clk", 0, &clk_input_length-1)==STRING.CUT("&clk", -1))
    ( 
      &match=1
    )
  )	  
  else if ("wcss_common_xo_clk"=="&clk")
  (
    &match=1
  )
  
  if (&match==1)
  (
    &clk_test=&CLK_TEST_WCSS_COMMON_XO_CLK
    &clk_reg=&HWIO_WCSS_A_PMU_COMMON_XO_CBCR_ADDR
    &clk_reg_name="WCSS_A_PMU_COMMON_XO_CBCR"
    &clk_name="wcss_common_xo_clk"
    &clk_reg_cbcr_type="sm_cbc"

    gosub Print_Clk_Info_Line
  )
  
  &match=0
  &wild_head=0
  &wild_tail=0
  &clk_input_length=STRING.LENGTH("&clk")
  &clk_itr_length=STRING.LENGTH("o_wcss_ahb_s0_clk")

  if (STRING.SCAN("&clk", "*", 0)==0)
  (
    &wild_head=1
  )
  if (STRING.SCAN("&clk", "*", 1)==(STRING.LENGTH("&clk")-1))
  (
    &wild_tail=1
  )

  if ((&wild_head==1)&&(&wild_tail==1))
  (
    if (STRING.SCAN("o_wcss_ahb_s0_clk", STRING.MID("&clk", 1, &clk_input_length-2), 0)!=-1)
    ( 
      &match=1
    )
  )
  else if (&wild_head==1)
  (
    if (STRING.MID("o_wcss_ahb_s0_clk", &clk_itr_length-&clk_input_length+1, &clk_input_length-1)==STRING.CUT("&clk", 1))
    ( 
      &match=1
    )
  )
  else if (&wild_tail==1)
  (
    if (STRING.MID("o_wcss_ahb_s0_clk", 0, &clk_input_length-1)==STRING.CUT("&clk", -1))
    ( 
      &match=1
    )
  )	  
  else if ("o_wcss_ahb_s0_clk"=="&clk")
  (
    &match=1
  )
  
  if (&match==1)
  (
    &clk_test=&CLK_TEST_O_WCSS_AHB_S0_CLK
    &clk_reg=0
    &clk_reg_name="No CBCR"
    &clk_name="o_wcss_ahb_s0_clk"
    &clk_reg_cbcr_type=""

    gosub Print_Clk_Info_Line
  )
  
  &match=0
  &wild_head=0
  &wild_tail=0
  &clk_input_length=STRING.LENGTH("&clk")
  &clk_itr_length=STRING.LENGTH("o_wcss_axi_m_clk")

  if (STRING.SCAN("&clk", "*", 0)==0)
  (
    &wild_head=1
  )
  if (STRING.SCAN("&clk", "*", 1)==(STRING.LENGTH("&clk")-1))
  (
    &wild_tail=1
  )

  if ((&wild_head==1)&&(&wild_tail==1))
  (
    if (STRING.SCAN("o_wcss_axi_m_clk", STRING.MID("&clk", 1, &clk_input_length-2), 0)!=-1)
    ( 
      &match=1
    )
  )
  else if (&wild_head==1)
  (
    if (STRING.MID("o_wcss_axi_m_clk", &clk_itr_length-&clk_input_length+1, &clk_input_length-1)==STRING.CUT("&clk", 1))
    ( 
      &match=1
    )
  )
  else if (&wild_tail==1)
  (
    if (STRING.MID("o_wcss_axi_m_clk", 0, &clk_input_length-1)==STRING.CUT("&clk", -1))
    ( 
      &match=1
    )
  )	  
  else if ("o_wcss_axi_m_clk"=="&clk")
  (
    &match=1
  )
  
  if (&match==1)
  (
    &clk_test=&CLK_TEST_O_WCSS_AXI_M_CLK
    &clk_reg=0
    &clk_reg_name="No CBCR"
    &clk_name="o_wcss_axi_m_clk"
    &clk_reg_cbcr_type="sm_cbc"

    gosub Print_Clk_Info_Line
  )
  
  &match=0
  &wild_head=0
  &wild_tail=0
  &clk_input_length=STRING.LENGTH("&clk")
  &clk_itr_length=STRING.LENGTH("o_wcss_bus_timeout_clk")

  if (STRING.SCAN("&clk", "*", 0)==0)
  (
    &wild_head=1
  )
  if (STRING.SCAN("&clk", "*", 1)==(STRING.LENGTH("&clk")-1))
  (
    &wild_tail=1
  )

  if ((&wild_head==1)&&(&wild_tail==1))
  (
    if (STRING.SCAN("o_wcss_bus_timeout_clk", STRING.MID("&clk", 1, &clk_input_length-2), 0)!=-1)
    ( 
      &match=1
    )
  )
  else if (&wild_head==1)
  (
    if (STRING.MID("o_wcss_bus_timeout_clk", &clk_itr_length-&clk_input_length+1, &clk_input_length-1)==STRING.CUT("&clk", 1))
    ( 
      &match=1
    )
  )
  else if (&wild_tail==1)
  (
    if (STRING.MID("o_wcss_bus_timeout_clk", 0, &clk_input_length-1)==STRING.CUT("&clk", -1))
    ( 
      &match=1
    )
  )	  
  else if ("o_wcss_bus_timeout_clk"=="&clk")
  (
    &match=1
  )
  
  if (&match==1)
  (
    &clk_test=&CLK_TEST_O_WCSS_BUS_TIMEOUT_CLK
    &clk_reg=0
    &clk_reg_name="No CBCR"
    &clk_name="o_wcss_bus_timeout_clk"
    &clk_reg_cbcr_type="sm_cbc"

    gosub Print_Clk_Info_Line
  )
  
  &match=0
  &wild_head=0
  &wild_tail=0
  &clk_input_length=STRING.LENGTH("&clk")
  &clk_itr_length=STRING.LENGTH("wcss_cpu_ahb_clk_src")

  if (STRING.SCAN("&clk", "*", 0)==0)
  (
    &wild_head=1
  )
  if (STRING.SCAN("&clk", "*", 1)==(STRING.LENGTH("&clk")-1))
  (
    &wild_tail=1
  )

  if ((&wild_head==1)&&(&wild_tail==1))
  (
    if (STRING.SCAN("wcss_cpu_ahb_clk_src", STRING.MID("&clk", 1, &clk_input_length-2), 0)!=-1)
    ( 
      &match=1
    )
  )
  else if (&wild_head==1)
  (
    if (STRING.MID("wcss_cpu_ahb_clk_src", &clk_itr_length-&clk_input_length+1, &clk_input_length-1)==STRING.CUT("&clk", 1))
    ( 
      &match=1
    )
  )
  else if (&wild_tail==1)
  (
    if (STRING.MID("wcss_cpu_ahb_clk_src", 0, &clk_input_length-1)==STRING.CUT("&clk", -1))
    ( 
      &match=1
    )
  )	  
  else if ("wcss_cpu_ahb_clk_src"=="&clk")
  (
    &match=1
  )
  
  if (&match==1)
  (
    &clk_test=&CLK_TEST_WCSS_CPU_AHB_CLK_SRC
    &clk_reg=0
    &clk_reg_name="No CBCR"
    &clk_name="wcss_cpu_ahb_clk_src"
    &clk_reg_cbcr_type=""

    gosub Print_Clk_Info_Line
  )
  
  &match=0
  &wild_head=0
  &wild_tail=0
  &clk_input_length=STRING.LENGTH("&clk")
  &clk_itr_length=STRING.LENGTH("wcss_slp_clk_src")

  if (STRING.SCAN("&clk", "*", 0)==0)
  (
    &wild_head=1
  )
  if (STRING.SCAN("&clk", "*", 1)==(STRING.LENGTH("&clk")-1))
  (
    &wild_tail=1
  )

  if ((&wild_head==1)&&(&wild_tail==1))
  (
    if (STRING.SCAN("wcss_slp_clk_src", STRING.MID("&clk", 1, &clk_input_length-2), 0)!=-1)
    ( 
      &match=1
    )
  )
  else if (&wild_head==1)
  (
    if (STRING.MID("wcss_slp_clk_src", &clk_itr_length-&clk_input_length+1, &clk_input_length-1)==STRING.CUT("&clk", 1))
    ( 
      &match=1
    )
  )
  else if (&wild_tail==1)
  (
    if (STRING.MID("wcss_slp_clk_src", 0, &clk_input_length-1)==STRING.CUT("&clk", -1))
    ( 
      &match=1
    )
  )	  
  else if ("wcss_slp_clk_src"=="&clk")
  (
    &match=1
  )
  
  if (&match==1)
  (
    &clk_test=&CLK_TEST_WCSS_SLP_CLK_SRC
    &clk_reg=0
    &clk_reg_name="No CBCR"
    &clk_name="wcss_slp_clk_src"
    &clk_reg_cbcr_type=""

    gosub Print_Clk_Info_Line
  )
  
  &match=0
  &wild_head=0
  &wild_tail=0
  &clk_input_length=STRING.LENGTH("&clk")
  &clk_itr_length=STRING.LENGTH("wcss_top_ahb_clk")

  if (STRING.SCAN("&clk", "*", 0)==0)
  (
    &wild_head=1
  )
  if (STRING.SCAN("&clk", "*", 1)==(STRING.LENGTH("&clk")-1))
  (
    &wild_tail=1
  )

  if ((&wild_head==1)&&(&wild_tail==1))
  (
    if (STRING.SCAN("wcss_top_ahb_clk", STRING.MID("&clk", 1, &clk_input_length-2), 0)!=-1)
    ( 
      &match=1
    )
  )
  else if (&wild_head==1)
  (
    if (STRING.MID("wcss_top_ahb_clk", &clk_itr_length-&clk_input_length+1, &clk_input_length-1)==STRING.CUT("&clk", 1))
    ( 
      &match=1
    )
  )
  else if (&wild_tail==1)
  (
    if (STRING.MID("wcss_top_ahb_clk", 0, &clk_input_length-1)==STRING.CUT("&clk", -1))
    ( 
      &match=1
    )
  )	  
  else if ("wcss_top_ahb_clk"=="&clk")
  (
    &match=1
  )
  
  if (&match==1)
  (
    &clk_test=&CLK_TEST_WCSS_TOP_AHB_CLK
    &clk_reg=&HWIO_WCSS_A_PMU_TOP_AHB_CBCR_ADDR
    &clk_reg_name="WCSS_A_PMU_TOP_AHB_CBCR"
    &clk_name="wcss_top_ahb_clk"
    &clk_reg_cbcr_type="sm_cbc"

    gosub Print_Clk_Info_Line
  )
  
  &match=0
  &wild_head=0
  &wild_tail=0
  &clk_input_length=STRING.LENGTH("&clk")
  &clk_itr_length=STRING.LENGTH("wcss_top_slp_clk")

  if (STRING.SCAN("&clk", "*", 0)==0)
  (
    &wild_head=1
  )
  if (STRING.SCAN("&clk", "*", 1)==(STRING.LENGTH("&clk")-1))
  (
    &wild_tail=1
  )

  if ((&wild_head==1)&&(&wild_tail==1))
  (
    if (STRING.SCAN("wcss_top_slp_clk", STRING.MID("&clk", 1, &clk_input_length-2), 0)!=-1)
    ( 
      &match=1
    )
  )
  else if (&wild_head==1)
  (
    if (STRING.MID("wcss_top_slp_clk", &clk_itr_length-&clk_input_length+1, &clk_input_length-1)==STRING.CUT("&clk", 1))
    ( 
      &match=1
    )
  )
  else if (&wild_tail==1)
  (
    if (STRING.MID("wcss_top_slp_clk", 0, &clk_input_length-1)==STRING.CUT("&clk", -1))
    ( 
      &match=1
    )
  )	  
  else if ("wcss_top_slp_clk"=="&clk")
  (
    &match=1
  )
  
  if (&match==1)
  (
    &clk_test=&CLK_TEST_WCSS_TOP_SLP_CLK
    &clk_reg=&HWIO_WCSS_A_PMU_TOP_SLP_CBCR_ADDR
    &clk_reg_name="WCSS_A_PMU_TOP_SLP_CBCR"
    &clk_name="wcss_top_slp_clk"
    &clk_reg_cbcr_type="sm_cbc"

    gosub Print_Clk_Info_Line
  )
  
  &match=0
  &wild_head=0
  &wild_tail=0
  &clk_input_length=STRING.LENGTH("&clk")
  &clk_itr_length=STRING.LENGTH("wcss_top_xo_clk")

  if (STRING.SCAN("&clk", "*", 0)==0)
  (
    &wild_head=1
  )
  if (STRING.SCAN("&clk", "*", 1)==(STRING.LENGTH("&clk")-1))
  (
    &wild_tail=1
  )

  if ((&wild_head==1)&&(&wild_tail==1))
  (
    if (STRING.SCAN("wcss_top_xo_clk", STRING.MID("&clk", 1, &clk_input_length-2), 0)!=-1)
    ( 
      &match=1
    )
  )
  else if (&wild_head==1)
  (
    if (STRING.MID("wcss_top_xo_clk", &clk_itr_length-&clk_input_length+1, &clk_input_length-1)==STRING.CUT("&clk", 1))
    ( 
      &match=1
    )
  )
  else if (&wild_tail==1)
  (
    if (STRING.MID("wcss_top_xo_clk", 0, &clk_input_length-1)==STRING.CUT("&clk", -1))
    ( 
      &match=1
    )
  )	  
  else if ("wcss_top_xo_clk"=="&clk")
  (
    &match=1
  )
  
  if (&match==1)
  (
    &clk_test=&CLK_TEST_WCSS_TOP_XO_CLK
    &clk_reg=&HWIO_WCSS_A_PMU_TOP_XO_CBCR_ADDR
    &clk_reg_name="WCSS_A_PMU_TOP_XO_CBCR"
    &clk_name="wcss_top_xo_clk"
    &clk_reg_cbcr_type="sm_cbc"

    gosub Print_Clk_Info_Line
  )
  
  &match=0
  &wild_head=0
  &wild_tail=0
  &clk_input_length=STRING.LENGTH("&clk")
  &clk_itr_length=STRING.LENGTH("wcss_xo_clk_src")

  if (STRING.SCAN("&clk", "*", 0)==0)
  (
    &wild_head=1
  )
  if (STRING.SCAN("&clk", "*", 1)==(STRING.LENGTH("&clk")-1))
  (
    &wild_tail=1
  )

  if ((&wild_head==1)&&(&wild_tail==1))
  (
    if (STRING.SCAN("wcss_xo_clk_src", STRING.MID("&clk", 1, &clk_input_length-2), 0)!=-1)
    ( 
      &match=1
    )
  )
  else if (&wild_head==1)
  (
    if (STRING.MID("wcss_xo_clk_src", &clk_itr_length-&clk_input_length+1, &clk_input_length-1)==STRING.CUT("&clk", 1))
    ( 
      &match=1
    )
  )
  else if (&wild_tail==1)
  (
    if (STRING.MID("wcss_xo_clk_src", 0, &clk_input_length-1)==STRING.CUT("&clk", -1))
    ( 
      &match=1
    )
  )	  
  else if ("wcss_xo_clk_src"=="&clk")
  (
    &match=1
  )
  
  if (&match==1)
  (
    &clk_test=&CLK_TEST_WCSS_XO_CLK_SRC
    &clk_reg=0
    &clk_reg_name="No CBCR"
    &clk_name="wcss_xo_clk_src"
    &clk_reg_cbcr_type=""

    gosub Print_Clk_Info_Line
  )
  
  &match=0
  &wild_head=0
  &wild_tail=0
  &clk_input_length=STRING.LENGTH("&clk")
  &clk_itr_length=STRING.LENGTH("o_wcss_adc_240m_clk")

  if (STRING.SCAN("&clk", "*", 0)==0)
  (
    &wild_head=1
  )
  if (STRING.SCAN("&clk", "*", 1)==(STRING.LENGTH("&clk")-1))
  (
    &wild_tail=1
  )

  if ((&wild_head==1)&&(&wild_tail==1))
  (
    if (STRING.SCAN("o_wcss_adc_240m_clk", STRING.MID("&clk", 1, &clk_input_length-2), 0)!=-1)
    ( 
      &match=1
    )
  )
  else if (&wild_head==1)
  (
    if (STRING.MID("o_wcss_adc_240m_clk", &clk_itr_length-&clk_input_length+1, &clk_input_length-1)==STRING.CUT("&clk", 1))
    ( 
      &match=1
    )
  )
  else if (&wild_tail==1)
  (
    if (STRING.MID("o_wcss_adc_240m_clk", 0, &clk_input_length-1)==STRING.CUT("&clk", -1))
    ( 
      &match=1
    )
  )	  
  else if ("o_wcss_adc_240m_clk"=="&clk")
  (
    &match=1
  )
  
  if (&match==1)
  (
    &clk_test=&CLK_TEST_O_WCSS_ADC_240M_CLK
    &clk_reg=0
    &clk_reg_name="No CBCR"
    &clk_name="o_wcss_adc_240m_clk"
    &clk_reg_cbcr_type="sm_cbc"

    gosub Print_Clk_Info_Line
  )
  
  &match=0
  &wild_head=0
  &wild_tail=0
  &clk_input_length=STRING.LENGTH("&clk")
  &clk_itr_length=STRING.LENGTH("wcss_dac_sm_clk")

  if (STRING.SCAN("&clk", "*", 0)==0)
  (
    &wild_head=1
  )
  if (STRING.SCAN("&clk", "*", 1)==(STRING.LENGTH("&clk")-1))
  (
    &wild_tail=1
  )

  if ((&wild_head==1)&&(&wild_tail==1))
  (
    if (STRING.SCAN("wcss_dac_sm_clk", STRING.MID("&clk", 1, &clk_input_length-2), 0)!=-1)
    ( 
      &match=1
    )
  )
  else if (&wild_head==1)
  (
    if (STRING.MID("wcss_dac_sm_clk", &clk_itr_length-&clk_input_length+1, &clk_input_length-1)==STRING.CUT("&clk", 1))
    ( 
      &match=1
    )
  )
  else if (&wild_tail==1)
  (
    if (STRING.MID("wcss_dac_sm_clk", 0, &clk_input_length-1)==STRING.CUT("&clk", -1))
    ( 
      &match=1
    )
  )	  
  else if ("wcss_dac_sm_clk"=="&clk")
  (
    &match=1
  )
  
  if (&match==1)
  (
    &clk_test=&CLK_TEST_WCSS_DAC_SM_CLK
    &clk_reg=&HWIO_WCSS_A_PMU_DAC_SM_CBCR_ADDR
    &clk_reg_name="WCSS_A_PMU_DAC_SM_CBCR"
    &clk_name="wcss_dac_sm_clk"
    &clk_reg_cbcr_type="sm_cbc"

    gosub Print_Clk_Info_Line
  )
  
  &match=0
  &wild_head=0
  &wild_tail=0
  &clk_input_length=STRING.LENGTH("&clk")
  &clk_itr_length=STRING.LENGTH("wcss_rfif_clk_src")

  if (STRING.SCAN("&clk", "*", 0)==0)
  (
    &wild_head=1
  )
  if (STRING.SCAN("&clk", "*", 1)==(STRING.LENGTH("&clk")-1))
  (
    &wild_tail=1
  )

  if ((&wild_head==1)&&(&wild_tail==1))
  (
    if (STRING.SCAN("wcss_rfif_clk_src", STRING.MID("&clk", 1, &clk_input_length-2), 0)!=-1)
    ( 
      &match=1
    )
  )
  else if (&wild_head==1)
  (
    if (STRING.MID("wcss_rfif_clk_src", &clk_itr_length-&clk_input_length+1, &clk_input_length-1)==STRING.CUT("&clk", 1))
    ( 
      &match=1
    )
  )
  else if (&wild_tail==1)
  (
    if (STRING.MID("wcss_rfif_clk_src", 0, &clk_input_length-1)==STRING.CUT("&clk", -1))
    ( 
      &match=1
    )
  )	  
  else if ("wcss_rfif_clk_src"=="&clk")
  (
    &match=1
  )
  
  if (&match==1)
  (
    &clk_test=&CLK_TEST_WCSS_RFIF_CLK_SRC
    &clk_reg=0
    &clk_reg_name="No CBCR"
    &clk_name="wcss_rfif_clk_src"
    &clk_reg_cbcr_type=""

    gosub Print_Clk_Info_Line
  )
  
  &match=0
  &wild_head=0
  &wild_tail=0
  &clk_input_length=STRING.LENGTH("&clk")
  &clk_itr_length=STRING.LENGTH("wcss_wlan_adc_clk")

  if (STRING.SCAN("&clk", "*", 0)==0)
  (
    &wild_head=1
  )
  if (STRING.SCAN("&clk", "*", 1)==(STRING.LENGTH("&clk")-1))
  (
    &wild_tail=1
  )

  if ((&wild_head==1)&&(&wild_tail==1))
  (
    if (STRING.SCAN("wcss_wlan_adc_clk", STRING.MID("&clk", 1, &clk_input_length-2), 0)!=-1)
    ( 
      &match=1
    )
  )
  else if (&wild_head==1)
  (
    if (STRING.MID("wcss_wlan_adc_clk", &clk_itr_length-&clk_input_length+1, &clk_input_length-1)==STRING.CUT("&clk", 1))
    ( 
      &match=1
    )
  )
  else if (&wild_tail==1)
  (
    if (STRING.MID("wcss_wlan_adc_clk", 0, &clk_input_length-1)==STRING.CUT("&clk", -1))
    ( 
      &match=1
    )
  )	  
  else if ("wcss_wlan_adc_clk"=="&clk")
  (
    &match=1
  )
  
  if (&match==1)
  (
    &clk_test=&CLK_TEST_WCSS_WLAN_ADC_CLK
    &clk_reg=0
    &clk_reg_name="No CBCR"
    &clk_name="wcss_wlan_adc_clk"
    &clk_reg_cbcr_type="sm_cbc"

    gosub Print_Clk_Info_Line
  )
  
  &match=0
  &wild_head=0
  &wild_tail=0
  &clk_input_length=STRING.LENGTH("&clk")
  &clk_itr_length=STRING.LENGTH("wcss_wlan_ahb_clk")

  if (STRING.SCAN("&clk", "*", 0)==0)
  (
    &wild_head=1
  )
  if (STRING.SCAN("&clk", "*", 1)==(STRING.LENGTH("&clk")-1))
  (
    &wild_tail=1
  )

  if ((&wild_head==1)&&(&wild_tail==1))
  (
    if (STRING.SCAN("wcss_wlan_ahb_clk", STRING.MID("&clk", 1, &clk_input_length-2), 0)!=-1)
    ( 
      &match=1
    )
  )
  else if (&wild_head==1)
  (
    if (STRING.MID("wcss_wlan_ahb_clk", &clk_itr_length-&clk_input_length+1, &clk_input_length-1)==STRING.CUT("&clk", 1))
    ( 
      &match=1
    )
  )
  else if (&wild_tail==1)
  (
    if (STRING.MID("wcss_wlan_ahb_clk", 0, &clk_input_length-1)==STRING.CUT("&clk", -1))
    ( 
      &match=1
    )
  )	  
  else if ("wcss_wlan_ahb_clk"=="&clk")
  (
    &match=1
  )
  
  if (&match==1)
  (
    &clk_test=&CLK_TEST_WCSS_WLAN_AHB_CLK
    &clk_reg=&HWIO_WCSS_A_PMU_WLAN_AHB_CBCR_ADDR
    &clk_reg_name="WCSS_A_PMU_WLAN_AHB_CBCR"
    &clk_name="wcss_wlan_ahb_clk"
    &clk_reg_cbcr_type="sm_pscbc"

    gosub Print_Clk_Info_Line
  )
  
  &match=0
  &wild_head=0
  &wild_tail=0
  &clk_input_length=STRING.LENGTH("&clk")
  &clk_itr_length=STRING.LENGTH("wcss_wlan_phy_dac_clk")

  if (STRING.SCAN("&clk", "*", 0)==0)
  (
    &wild_head=1
  )
  if (STRING.SCAN("&clk", "*", 1)==(STRING.LENGTH("&clk")-1))
  (
    &wild_tail=1
  )

  if ((&wild_head==1)&&(&wild_tail==1))
  (
    if (STRING.SCAN("wcss_wlan_phy_dac_clk", STRING.MID("&clk", 1, &clk_input_length-2), 0)!=-1)
    ( 
      &match=1
    )
  )
  else if (&wild_head==1)
  (
    if (STRING.MID("wcss_wlan_phy_dac_clk", &clk_itr_length-&clk_input_length+1, &clk_input_length-1)==STRING.CUT("&clk", 1))
    ( 
      &match=1
    )
  )
  else if (&wild_tail==1)
  (
    if (STRING.MID("wcss_wlan_phy_dac_clk", 0, &clk_input_length-1)==STRING.CUT("&clk", -1))
    ( 
      &match=1
    )
  )	  
  else if ("wcss_wlan_phy_dac_clk"=="&clk")
  (
    &match=1
  )
  
  if (&match==1)
  (
    &clk_test=&CLK_TEST_WCSS_WLAN_PHY_DAC_CLK
    &clk_reg=&HWIO_WCSS_A_PMU_WLAN_PHY_DAC_CBCR_ADDR
    &clk_reg_name="WCSS_A_PMU_WLAN_PHY_DAC_CBCR"
    &clk_name="wcss_wlan_phy_dac_clk"
    &clk_reg_cbcr_type="sm_cbc"

    gosub Print_Clk_Info_Line
  )
  
  &match=0
  &wild_head=0
  &wild_tail=0
  &clk_input_length=STRING.LENGTH("&clk")
  &clk_itr_length=STRING.LENGTH("wcss_wlan_phy_dbg_clk")

  if (STRING.SCAN("&clk", "*", 0)==0)
  (
    &wild_head=1
  )
  if (STRING.SCAN("&clk", "*", 1)==(STRING.LENGTH("&clk")-1))
  (
    &wild_tail=1
  )

  if ((&wild_head==1)&&(&wild_tail==1))
  (
    if (STRING.SCAN("wcss_wlan_phy_dbg_clk", STRING.MID("&clk", 1, &clk_input_length-2), 0)!=-1)
    ( 
      &match=1
    )
  )
  else if (&wild_head==1)
  (
    if (STRING.MID("wcss_wlan_phy_dbg_clk", &clk_itr_length-&clk_input_length+1, &clk_input_length-1)==STRING.CUT("&clk", 1))
    ( 
      &match=1
    )
  )
  else if (&wild_tail==1)
  (
    if (STRING.MID("wcss_wlan_phy_dbg_clk", 0, &clk_input_length-1)==STRING.CUT("&clk", -1))
    ( 
      &match=1
    )
  )	  
  else if ("wcss_wlan_phy_dbg_clk"=="&clk")
  (
    &match=1
  )
  
  if (&match==1)
  (
    &clk_test=&CLK_TEST_WCSS_WLAN_PHY_DBG_CLK
    &clk_reg=&HWIO_WCSS_A_PMU_WLAN_PHY_DBG_CBCR_ADDR
    &clk_reg_name="WCSS_A_PMU_WLAN_PHY_DBG_CBCR"
    &clk_name="wcss_wlan_phy_dbg_clk"
    &clk_reg_cbcr_type="sm_cbc"

    gosub Print_Clk_Info_Line
  )
  
  &match=0
  &wild_head=0
  &wild_tail=0
  &clk_input_length=STRING.LENGTH("&clk")
  &clk_itr_length=STRING.LENGTH("wcss_wlan_phy_main1_fast_clk")

  if (STRING.SCAN("&clk", "*", 0)==0)
  (
    &wild_head=1
  )
  if (STRING.SCAN("&clk", "*", 1)==(STRING.LENGTH("&clk")-1))
  (
    &wild_tail=1
  )

  if ((&wild_head==1)&&(&wild_tail==1))
  (
    if (STRING.SCAN("wcss_wlan_phy_main1_fast_clk", STRING.MID("&clk", 1, &clk_input_length-2), 0)!=-1)
    ( 
      &match=1
    )
  )
  else if (&wild_head==1)
  (
    if (STRING.MID("wcss_wlan_phy_main1_fast_clk", &clk_itr_length-&clk_input_length+1, &clk_input_length-1)==STRING.CUT("&clk", 1))
    ( 
      &match=1
    )
  )
  else if (&wild_tail==1)
  (
    if (STRING.MID("wcss_wlan_phy_main1_fast_clk", 0, &clk_input_length-1)==STRING.CUT("&clk", -1))
    ( 
      &match=1
    )
  )	  
  else if ("wcss_wlan_phy_main1_fast_clk"=="&clk")
  (
    &match=1
  )
  
  if (&match==1)
  (
    &clk_test=&CLK_TEST_WCSS_WLAN_PHY_MAIN1_FAST_CLK
    &clk_reg=&HWIO_WCSS_A_PMU_WLAN_PHY_MAIN1_FAST_CBCR_ADDR
    &clk_reg_name="WCSS_A_PMU_WLAN_PHY_MAIN1_FAST_CBCR"
    &clk_name="wcss_wlan_phy_main1_fast_clk"
    &clk_reg_cbcr_type="sm_cbc"

    gosub Print_Clk_Info_Line
  )
  
  &match=0
  &wild_head=0
  &wild_tail=0
  &clk_input_length=STRING.LENGTH("&clk")
  &clk_itr_length=STRING.LENGTH("wcss_wlan_rfa_cal_clk")

  if (STRING.SCAN("&clk", "*", 0)==0)
  (
    &wild_head=1
  )
  if (STRING.SCAN("&clk", "*", 1)==(STRING.LENGTH("&clk")-1))
  (
    &wild_tail=1
  )

  if ((&wild_head==1)&&(&wild_tail==1))
  (
    if (STRING.SCAN("wcss_wlan_rfa_cal_clk", STRING.MID("&clk", 1, &clk_input_length-2), 0)!=-1)
    ( 
      &match=1
    )
  )
  else if (&wild_head==1)
  (
    if (STRING.MID("wcss_wlan_rfa_cal_clk", &clk_itr_length-&clk_input_length+1, &clk_input_length-1)==STRING.CUT("&clk", 1))
    ( 
      &match=1
    )
  )
  else if (&wild_tail==1)
  (
    if (STRING.MID("wcss_wlan_rfa_cal_clk", 0, &clk_input_length-1)==STRING.CUT("&clk", -1))
    ( 
      &match=1
    )
  )	  
  else if ("wcss_wlan_rfa_cal_clk"=="&clk")
  (
    &match=1
  )
  
  if (&match==1)
  (
    &clk_test=&CLK_TEST_WCSS_WLAN_RFA_CAL_CLK
    &clk_reg=&HWIO_WCSS_A_PMU_WLAN_RFA_CAL_CBCR_ADDR
    &clk_reg_name="WCSS_A_PMU_WLAN_RFA_CAL_CBCR"
    &clk_name="wcss_wlan_rfa_cal_clk"
    &clk_reg_cbcr_type="sm_cbc"

    gosub Print_Clk_Info_Line
  )
  
  &match=0
  &wild_head=0
  &wild_tail=0
  &clk_input_length=STRING.LENGTH("&clk")
  &clk_itr_length=STRING.LENGTH("wcss_wlan_rfif_clk")

  if (STRING.SCAN("&clk", "*", 0)==0)
  (
    &wild_head=1
  )
  if (STRING.SCAN("&clk", "*", 1)==(STRING.LENGTH("&clk")-1))
  (
    &wild_tail=1
  )

  if ((&wild_head==1)&&(&wild_tail==1))
  (
    if (STRING.SCAN("wcss_wlan_rfif_clk", STRING.MID("&clk", 1, &clk_input_length-2), 0)!=-1)
    ( 
      &match=1
    )
  )
  else if (&wild_head==1)
  (
    if (STRING.MID("wcss_wlan_rfif_clk", &clk_itr_length-&clk_input_length+1, &clk_input_length-1)==STRING.CUT("&clk", 1))
    ( 
      &match=1
    )
  )
  else if (&wild_tail==1)
  (
    if (STRING.MID("wcss_wlan_rfif_clk", 0, &clk_input_length-1)==STRING.CUT("&clk", -1))
    ( 
      &match=1
    )
  )	  
  else if ("wcss_wlan_rfif_clk"=="&clk")
  (
    &match=1
  )
  
  if (&match==1)
  (
    &clk_test=&CLK_TEST_WCSS_WLAN_RFIF_CLK
    &clk_reg=&HWIO_WCSS_A_PMU_WLAN_RFIF_CBCR_ADDR
    &clk_reg_name="WCSS_A_PMU_WLAN_RFIF_CBCR"
    &clk_name="wcss_wlan_rfif_clk"
    &clk_reg_cbcr_type="sm_cbc"

    gosub Print_Clk_Info_Line
  )
  
  &match=0
  &wild_head=0
  &wild_tail=0
  &clk_input_length=STRING.LENGTH("&clk")
  &clk_itr_length=STRING.LENGTH("wlan_phy_main1_rx_clk")

  if (STRING.SCAN("&clk", "*", 0)==0)
  (
    &wild_head=1
  )
  if (STRING.SCAN("&clk", "*", 1)==(STRING.LENGTH("&clk")-1))
  (
    &wild_tail=1
  )

  if ((&wild_head==1)&&(&wild_tail==1))
  (
    if (STRING.SCAN("wlan_phy_main1_rx_clk", STRING.MID("&clk", 1, &clk_input_length-2), 0)!=-1)
    ( 
      &match=1
    )
  )
  else if (&wild_head==1)
  (
    if (STRING.MID("wlan_phy_main1_rx_clk", &clk_itr_length-&clk_input_length+1, &clk_input_length-1)==STRING.CUT("&clk", 1))
    ( 
      &match=1
    )
  )
  else if (&wild_tail==1)
  (
    if (STRING.MID("wlan_phy_main1_rx_clk", 0, &clk_input_length-1)==STRING.CUT("&clk", -1))
    ( 
      &match=1
    )
  )	  
  else if ("wlan_phy_main1_rx_clk"=="&clk")
  (
    &match=1
  )
  
  if (&match==1)
  (
    &clk_test=&CLK_TEST_WLAN_PHY_MAIN1_RX_CLK
    &clk_reg=&HWIO_WCSS_A_PMU_WLAN_PHY_MAIN1_RX_CBCR_ADDR
    &clk_reg_name="WCSS_A_PMU_WLAN_PHY_MAIN1_RX_CBCR"
    &clk_name="wlan_phy_main1_rx_clk"
    &clk_reg_cbcr_type="sm_pscbc"

    gosub Print_Clk_Info_Line
  )
  
  &match=0
  &wild_head=0
  &wild_tail=0
  &clk_input_length=STRING.LENGTH("&clk")
  &clk_itr_length=STRING.LENGTH("wlan_phy_main1_tx_clk")

  if (STRING.SCAN("&clk", "*", 0)==0)
  (
    &wild_head=1
  )
  if (STRING.SCAN("&clk", "*", 1)==(STRING.LENGTH("&clk")-1))
  (
    &wild_tail=1
  )

  if ((&wild_head==1)&&(&wild_tail==1))
  (
    if (STRING.SCAN("wlan_phy_main1_tx_clk", STRING.MID("&clk", 1, &clk_input_length-2), 0)!=-1)
    ( 
      &match=1
    )
  )
  else if (&wild_head==1)
  (
    if (STRING.MID("wlan_phy_main1_tx_clk", &clk_itr_length-&clk_input_length+1, &clk_input_length-1)==STRING.CUT("&clk", 1))
    ( 
      &match=1
    )
  )
  else if (&wild_tail==1)
  (
    if (STRING.MID("wlan_phy_main1_tx_clk", 0, &clk_input_length-1)==STRING.CUT("&clk", -1))
    ( 
      &match=1
    )
  )	  
  else if ("wlan_phy_main1_tx_clk"=="&clk")
  (
    &match=1
  )
  
  if (&match==1)
  (
    &clk_test=&CLK_TEST_WLAN_PHY_MAIN1_TX_CLK
    &clk_reg=&HWIO_WCSS_A_PMU_WLAN_PHY_MAIN1_TX_CBCR_ADDR
    &clk_reg_name="WCSS_A_PMU_WLAN_PHY_MAIN1_TX_CBCR"
    &clk_name="wlan_phy_main1_tx_clk"
    &clk_reg_cbcr_type="sm_pscbc"

    gosub Print_Clk_Info_Line
  )
  
  &match=0
  &wild_head=0
  &wild_tail=0
  &clk_input_length=STRING.LENGTH("&clk")
  &clk_itr_length=STRING.LENGTH("wlan_phy_main2_clk")

  if (STRING.SCAN("&clk", "*", 0)==0)
  (
    &wild_head=1
  )
  if (STRING.SCAN("&clk", "*", 1)==(STRING.LENGTH("&clk")-1))
  (
    &wild_tail=1
  )

  if ((&wild_head==1)&&(&wild_tail==1))
  (
    if (STRING.SCAN("wlan_phy_main2_clk", STRING.MID("&clk", 1, &clk_input_length-2), 0)!=-1)
    ( 
      &match=1
    )
  )
  else if (&wild_head==1)
  (
    if (STRING.MID("wlan_phy_main2_clk", &clk_itr_length-&clk_input_length+1, &clk_input_length-1)==STRING.CUT("&clk", 1))
    ( 
      &match=1
    )
  )
  else if (&wild_tail==1)
  (
    if (STRING.MID("wlan_phy_main2_clk", 0, &clk_input_length-1)==STRING.CUT("&clk", -1))
    ( 
      &match=1
    )
  )	  
  else if ("wlan_phy_main2_clk"=="&clk")
  (
    &match=1
  )
  
  if (&match==1)
  (
    &clk_test=&CLK_TEST_WLAN_PHY_MAIN2_CLK
    &clk_reg=&HWIO_WCSS_A_PMU_WLAN_PHY_MAIN2_CBCR_ADDR
    &clk_reg_name="WCSS_A_PMU_WLAN_PHY_MAIN2_CBCR"
    &clk_name="wlan_phy_main2_clk"
    &clk_reg_cbcr_type="sm_pscbc"

    gosub Print_Clk_Info_Line
  )
  
; Setting appropriate access mode for non-MSS clocks
&clk_access_mod="a:"

  &match=0
  &wild_head=0
  &wild_tail=0
  &clk_input_length=STRING.LENGTH("&clk")
  &clk_itr_length=STRING.LENGTH("apcs_hdcd_ahbgated_clk")

  if (STRING.SCAN("&clk", "*", 0)==0)
  (
    &wild_head=1
  )
  if (STRING.SCAN("&clk", "*", 1)==(STRING.LENGTH("&clk")-1))
  (
    &wild_tail=1
  )

  if ((&wild_head==1)&&(&wild_tail==1))
  (
    if (STRING.SCAN("apcs_hdcd_ahbgated_clk", STRING.MID("&clk", 1, &clk_input_length-2), 0)!=-1)
    ( 
      &match=1
    )
  )
  else if (&wild_head==1)
  (
    if (STRING.MID("apcs_hdcd_ahbgated_clk", &clk_itr_length-&clk_input_length+1, &clk_input_length-1)==STRING.CUT("&clk", 1))
    ( 
      &match=1
    )
  )
  else if (&wild_tail==1)
  (
    if (STRING.MID("apcs_hdcd_ahbgated_clk", 0, &clk_input_length-1)==STRING.CUT("&clk", -1))
    ( 
      &match=1
    )
  )	  
  else if ("apcs_hdcd_ahbgated_clk"=="&clk")
  (
    &match=1
  )
  
  if (&match==1)
  (
    &clk_test=&CLK_TEST_APCS_HDCD_AHBGATED_CLK
    &clk_reg=0
    &clk_reg_name="No CBCR"
    &clk_name="apcs_hdcd_ahbgated_clk"
    &clk_reg_cbcr_type=""

    gosub Print_Clk_Info_Line
  )
  
  &match=0
  &wild_head=0
  &wild_tail=0
  &clk_input_length=STRING.LENGTH("&clk")
  &clk_itr_length=STRING.LENGTH("apcs_imref_clk")

  if (STRING.SCAN("&clk", "*", 0)==0)
  (
    &wild_head=1
  )
  if (STRING.SCAN("&clk", "*", 1)==(STRING.LENGTH("&clk")-1))
  (
    &wild_tail=1
  )

  if ((&wild_head==1)&&(&wild_tail==1))
  (
    if (STRING.SCAN("apcs_imref_clk", STRING.MID("&clk", 1, &clk_input_length-2), 0)!=-1)
    ( 
      &match=1
    )
  )
  else if (&wild_head==1)
  (
    if (STRING.MID("apcs_imref_clk", &clk_itr_length-&clk_input_length+1, &clk_input_length-1)==STRING.CUT("&clk", 1))
    ( 
      &match=1
    )
  )
  else if (&wild_tail==1)
  (
    if (STRING.MID("apcs_imref_clk", 0, &clk_input_length-1)==STRING.CUT("&clk", -1))
    ( 
      &match=1
    )
  )	  
  else if ("apcs_imref_clk"=="&clk")
  (
    &match=1
  )
  
  if (&match==1)
  (
    &clk_test=&CLK_TEST_APCS_IMREF_CLK
    &clk_reg=0
    &clk_reg_name="No CBCR"
    &clk_name="apcs_imref_clk"
    &clk_reg_cbcr_type=""

    gosub Print_Clk_Info_Line
  )
  
  &match=0
  &wild_head=0
  &wild_tail=0
  &clk_input_length=STRING.LENGTH("&clk")
  &clk_itr_length=STRING.LENGTH("apcs_imsleep_clk")

  if (STRING.SCAN("&clk", "*", 0)==0)
  (
    &wild_head=1
  )
  if (STRING.SCAN("&clk", "*", 1)==(STRING.LENGTH("&clk")-1))
  (
    &wild_tail=1
  )

  if ((&wild_head==1)&&(&wild_tail==1))
  (
    if (STRING.SCAN("apcs_imsleep_clk", STRING.MID("&clk", 1, &clk_input_length-2), 0)!=-1)
    ( 
      &match=1
    )
  )
  else if (&wild_head==1)
  (
    if (STRING.MID("apcs_imsleep_clk", &clk_itr_length-&clk_input_length+1, &clk_input_length-1)==STRING.CUT("&clk", 1))
    ( 
      &match=1
    )
  )
  else if (&wild_tail==1)
  (
    if (STRING.MID("apcs_imsleep_clk", 0, &clk_input_length-1)==STRING.CUT("&clk", -1))
    ( 
      &match=1
    )
  )	  
  else if ("apcs_imsleep_clk"=="&clk")
  (
    &match=1
  )
  
  if (&match==1)
  (
    &clk_test=&CLK_TEST_APCS_IMSLEEP_CLK
    &clk_reg=0
    &clk_reg_name="No CBCR"
    &clk_name="apcs_imsleep_clk"
    &clk_reg_cbcr_type=""

    gosub Print_Clk_Info_Line
  )
  
  &match=0
  &wild_head=0
  &wild_tail=0
  &clk_input_length=STRING.LENGTH("&clk")
  &clk_itr_length=STRING.LENGTH("apcs_l2leaf_clk")

  if (STRING.SCAN("&clk", "*", 0)==0)
  (
    &wild_head=1
  )
  if (STRING.SCAN("&clk", "*", 1)==(STRING.LENGTH("&clk")-1))
  (
    &wild_tail=1
  )

  if ((&wild_head==1)&&(&wild_tail==1))
  (
    if (STRING.SCAN("apcs_l2leaf_clk", STRING.MID("&clk", 1, &clk_input_length-2), 0)!=-1)
    ( 
      &match=1
    )
  )
  else if (&wild_head==1)
  (
    if (STRING.MID("apcs_l2leaf_clk", &clk_itr_length-&clk_input_length+1, &clk_input_length-1)==STRING.CUT("&clk", 1))
    ( 
      &match=1
    )
  )
  else if (&wild_tail==1)
  (
    if (STRING.MID("apcs_l2leaf_clk", 0, &clk_input_length-1)==STRING.CUT("&clk", -1))
    ( 
      &match=1
    )
  )	  
  else if ("apcs_l2leaf_clk"=="&clk")
  (
    &match=1
  )
  
  ; This clock belongs to the 'cpus' display group.
  if ("cpus"=="&clk")
  (
    &match=1	  
  )
  
  if (&match==1)
  (
    &clk_test=&CLK_TEST_APCS_L2LEAF_CLK
    &clk_reg=0
    &clk_reg_name="No CBCR"
    &clk_name="apcs_l2leaf_clk"
    &clk_reg_cbcr_type=""

    gosub Print_Clk_Info_Line
  )
  
  &match=0
  &wild_head=0
  &wild_tail=0
  &clk_input_length=STRING.LENGTH("&clk")
  &clk_itr_length=STRING.LENGTH("apcs_leaf0_clk")

  if (STRING.SCAN("&clk", "*", 0)==0)
  (
    &wild_head=1
  )
  if (STRING.SCAN("&clk", "*", 1)==(STRING.LENGTH("&clk")-1))
  (
    &wild_tail=1
  )

  if ((&wild_head==1)&&(&wild_tail==1))
  (
    if (STRING.SCAN("apcs_leaf0_clk", STRING.MID("&clk", 1, &clk_input_length-2), 0)!=-1)
    ( 
      &match=1
    )
  )
  else if (&wild_head==1)
  (
    if (STRING.MID("apcs_leaf0_clk", &clk_itr_length-&clk_input_length+1, &clk_input_length-1)==STRING.CUT("&clk", 1))
    ( 
      &match=1
    )
  )
  else if (&wild_tail==1)
  (
    if (STRING.MID("apcs_leaf0_clk", 0, &clk_input_length-1)==STRING.CUT("&clk", -1))
    ( 
      &match=1
    )
  )	  
  else if ("apcs_leaf0_clk"=="&clk")
  (
    &match=1
  )
  
  ; This clock belongs to the 'cpus' display group.
  if ("cpus"=="&clk")
  (
    &match=1	  
  )
  
  if (&match==1)
  (
    &clk_test=&CLK_TEST_APCS_LEAF0_CLK
    &clk_reg=0
    &clk_reg_name="No CBCR"
    &clk_name="apcs_leaf0_clk"
    &clk_reg_cbcr_type=""

    gosub Print_Clk_Info_Line
  )
  
  &match=0
  &wild_head=0
  &wild_tail=0
  &clk_input_length=STRING.LENGTH("&clk")
  &clk_itr_length=STRING.LENGTH("apcs_leaf1_clk")

  if (STRING.SCAN("&clk", "*", 0)==0)
  (
    &wild_head=1
  )
  if (STRING.SCAN("&clk", "*", 1)==(STRING.LENGTH("&clk")-1))
  (
    &wild_tail=1
  )

  if ((&wild_head==1)&&(&wild_tail==1))
  (
    if (STRING.SCAN("apcs_leaf1_clk", STRING.MID("&clk", 1, &clk_input_length-2), 0)!=-1)
    ( 
      &match=1
    )
  )
  else if (&wild_head==1)
  (
    if (STRING.MID("apcs_leaf1_clk", &clk_itr_length-&clk_input_length+1, &clk_input_length-1)==STRING.CUT("&clk", 1))
    ( 
      &match=1
    )
  )
  else if (&wild_tail==1)
  (
    if (STRING.MID("apcs_leaf1_clk", 0, &clk_input_length-1)==STRING.CUT("&clk", -1))
    ( 
      &match=1
    )
  )	  
  else if ("apcs_leaf1_clk"=="&clk")
  (
    &match=1
  )
  
  ; This clock belongs to the 'cpus' display group.
  if ("cpus"=="&clk")
  (
    &match=1	  
  )
  
  if (&match==1)
  (
    &clk_test=&CLK_TEST_APCS_LEAF1_CLK
    &clk_reg=0
    &clk_reg_name="No CBCR"
    &clk_name="apcs_leaf1_clk"
    &clk_reg_cbcr_type=""

    gosub Print_Clk_Info_Line
  )
  
  &match=0
  &wild_head=0
  &wild_tail=0
  &clk_input_length=STRING.LENGTH("&clk")
  &clk_itr_length=STRING.LENGTH("apcs_leaf2_clk")

  if (STRING.SCAN("&clk", "*", 0)==0)
  (
    &wild_head=1
  )
  if (STRING.SCAN("&clk", "*", 1)==(STRING.LENGTH("&clk")-1))
  (
    &wild_tail=1
  )

  if ((&wild_head==1)&&(&wild_tail==1))
  (
    if (STRING.SCAN("apcs_leaf2_clk", STRING.MID("&clk", 1, &clk_input_length-2), 0)!=-1)
    ( 
      &match=1
    )
  )
  else if (&wild_head==1)
  (
    if (STRING.MID("apcs_leaf2_clk", &clk_itr_length-&clk_input_length+1, &clk_input_length-1)==STRING.CUT("&clk", 1))
    ( 
      &match=1
    )
  )
  else if (&wild_tail==1)
  (
    if (STRING.MID("apcs_leaf2_clk", 0, &clk_input_length-1)==STRING.CUT("&clk", -1))
    ( 
      &match=1
    )
  )	  
  else if ("apcs_leaf2_clk"=="&clk")
  (
    &match=1
  )
  
  ; This clock belongs to the 'cpus' display group.
  if ("cpus"=="&clk")
  (
    &match=1	  
  )
  
  if (&match==1)
  (
    &clk_test=&CLK_TEST_APCS_LEAF2_CLK
    &clk_reg=0
    &clk_reg_name="No CBCR"
    &clk_name="apcs_leaf2_clk"
    &clk_reg_cbcr_type=""

    gosub Print_Clk_Info_Line
  )
  
  &match=0
  &wild_head=0
  &wild_tail=0
  &clk_input_length=STRING.LENGTH("&clk")
  &clk_itr_length=STRING.LENGTH("apcs_leaf3_clk")

  if (STRING.SCAN("&clk", "*", 0)==0)
  (
    &wild_head=1
  )
  if (STRING.SCAN("&clk", "*", 1)==(STRING.LENGTH("&clk")-1))
  (
    &wild_tail=1
  )

  if ((&wild_head==1)&&(&wild_tail==1))
  (
    if (STRING.SCAN("apcs_leaf3_clk", STRING.MID("&clk", 1, &clk_input_length-2), 0)!=-1)
    ( 
      &match=1
    )
  )
  else if (&wild_head==1)
  (
    if (STRING.MID("apcs_leaf3_clk", &clk_itr_length-&clk_input_length+1, &clk_input_length-1)==STRING.CUT("&clk", 1))
    ( 
      &match=1
    )
  )
  else if (&wild_tail==1)
  (
    if (STRING.MID("apcs_leaf3_clk", 0, &clk_input_length-1)==STRING.CUT("&clk", -1))
    ( 
      &match=1
    )
  )	  
  else if ("apcs_leaf3_clk"=="&clk")
  (
    &match=1
  )
  
  ; This clock belongs to the 'cpus' display group.
  if ("cpus"=="&clk")
  (
    &match=1	  
  )
  
  if (&match==1)
  (
    &clk_test=&CLK_TEST_APCS_LEAF3_CLK
    &clk_reg=0
    &clk_reg_name="No CBCR"
    &clk_name="apcs_leaf3_clk"
    &clk_reg_cbcr_type=""

    gosub Print_Clk_Info_Line
  )
  
  &match=0
  &wild_head=0
  &wild_tail=0
  &clk_input_length=STRING.LENGTH("&clk")
  &clk_itr_length=STRING.LENGTH("apcs_sysqsb_clk")

  if (STRING.SCAN("&clk", "*", 0)==0)
  (
    &wild_head=1
  )
  if (STRING.SCAN("&clk", "*", 1)==(STRING.LENGTH("&clk")-1))
  (
    &wild_tail=1
  )

  if ((&wild_head==1)&&(&wild_tail==1))
  (
    if (STRING.SCAN("apcs_sysqsb_clk", STRING.MID("&clk", 1, &clk_input_length-2), 0)!=-1)
    ( 
      &match=1
    )
  )
  else if (&wild_head==1)
  (
    if (STRING.MID("apcs_sysqsb_clk", &clk_itr_length-&clk_input_length+1, &clk_input_length-1)==STRING.CUT("&clk", 1))
    ( 
      &match=1
    )
  )
  else if (&wild_tail==1)
  (
    if (STRING.MID("apcs_sysqsb_clk", 0, &clk_input_length-1)==STRING.CUT("&clk", -1))
    ( 
      &match=1
    )
  )	  
  else if ("apcs_sysqsb_clk"=="&clk")
  (
    &match=1
  )
  
  if (&match==1)
  (
    &clk_test=&CLK_TEST_APCS_SYSQSB_CLK
    &clk_reg=0
    &clk_reg_name="No CBCR"
    &clk_name="apcs_sysqsb_clk"
    &clk_reg_cbcr_type=""

    gosub Print_Clk_Info_Line
  )
  

  return
  


Set_Clock_Freq_Enter:


  print ""
  print "The selected clock does not support frequency configuration. Returning."
  print ""
  return
  
