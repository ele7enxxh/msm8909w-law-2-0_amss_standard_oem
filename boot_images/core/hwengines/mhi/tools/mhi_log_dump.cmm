ENTRY &file
data.save.binary &file var.range(*mhi_log)
