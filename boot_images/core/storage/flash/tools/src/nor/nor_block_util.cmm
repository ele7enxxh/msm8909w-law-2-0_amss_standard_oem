;============================================================================
;  Name:
;    NOR_BLOCK_UTIL.CMM
;
;  Description:
;    NOR block utility for Lauterbach JTAG/ICD TRACE32.
;
;  Execution:
;    Inside the debugger, type at the command line: "do blockutil".  Make
;    menu choices as directed.
;
;  Copyright (c) 2010-2011, 2014 Qualcomm Technologies Incorporated.
;  All Rights Reserved.
;  Qualcomm Confidential and Proprietary
;----------------------------------------------------------------------------
;============================================================================
;
;                        EDIT HISTORY FOR MODULE
;
; $Header: //components/rel/boot.bf/3.1.2.c3/boot_images/core/storage/flash/tools/src/nor/nor_block_util.cmm#1 $ 
; $DateTime: 2015/09/01 00:30:35 $ 
; $Author: pwbldsvc $
;
; when       who     what, where, why
; -------    ---     --------------------------------------------------------
; 03/31/14   whc     Updated to load correct param and elf
; 03/21/11   jz      Updated to support new T32 versions
; 09/03/10   sv      Created
;============================================================================;


;============================================================================
; Declare variables used
;============================================================================
local &DoDebug
local &Verbose
local &ClearWin
local &Choice
local &HideWarning
local &PauseTime
local &BlockToMark
local &BlockToErase
local &CurrentCmd

;============================================================================
; Set up some defaults for some variables
;============================================================================
&DoDebug="no"         ; Do not do debugging
&Verbose="yes"        ; Do not present status messages as we process
&ClearWin="yes"       ; Remove all windows before starting
&PauseTime="10.ms"    ; Time to pause without action
&HideWarning="no"     ; Set to "no" to show warning message at least once
&NorSrcRoot="../../../../.." ; setup the source root for scripts
;============================================================================
; For normal use set up the screen with only area window for reports
; For debug purposes, don't clear
; In both cases, make sure we have an area window
;============================================================================
if "&ClearWin"=="yes"
(
  WinCLEAR
  WinPage.Reset
  WINPOS 0. 0. 50% 80%
)
else
(
  WINPOS 0. 0. 50% 70%
  ; WINPOS 55% 70% 45% 30%
)
area

if "&ClearWin"=="yes"
(
  area.RESET
)

;============================================================================
; Initialze PATH with Current directory only. Other directory paths will be 
; appended later in respective modules
;============================================================================
PATH .

;============================================================================
; Set some MSM specific variables used later in flash.target command
;    &NorCodeAddr=
;    &NorParamAddr=
;    &NorCpuType=
;============================================================================
do nor_param_spi

;============================================================================
; 1) Set variables used to set up the JTAG debugger for this MSM
; 2) Init important MSM/ASB registers
;    use existing external script that is MSM specific
;============================================================================
do &NorConfigDir/nor_msm_init

;-------------------------------------------------------------------------------
; Set some variables used later on to peek and poke parameter block
;-------------------------------------------------------------------------------
do nor_init.cmm

;============================================================================
; Put up terminal window
;============================================================================
term.close               ;in case one is already up, flush it
winclear MYTERM
term.size 60 1000
term.scroll on
WinPOS 50% 0% 50% 50% ,, MYTERM
term.view
;term.write term.out

;======================================================
; Load our flash programming routine and prepare flash
;======================================================
d.load.elf "nor_tools_spi.elf"
data.load.elf "nor_tools_spi.elf" /VERIFY

; need this breakpoint as per Lauterbach Spec so that we
; can hand back control to the Debugger
break.delete /ALL
break.set swbp /onchip /program

;============================================================================
; Present user with normal main menu for NOR.  Manual selection is done.
;============================================================================
area.reset

MainMenu:
  print
  print
  print "/---------------------------------------------\"
  print "|               _   _  ___  ____              |"
  print "|              | \ | |/ _ \|  _ \             |"
  print "|              |  \| | | | | |_) |            |"
  print "|              | |\  | |_| |  _ <             |"
  print "|              |_| \_|\___/|_| \_\            |"
  print "|                                             |"
  print "|                                             |"
  print "|                                             |"
  print "|                Block Utility                |"
  print "|                                             |"
  print "|                                             |"
  print "|     Copyright (c) 2010 by QUALCOMM, Inc     |"
  print "|                                             |"
  print "-----------------------------------------------"
  print
  print
  print " 0: Exit"
  print " 1: Erase block"
  print
  print " Please make a choice: "

  &t32_cmm_stopped=1
  enter &Choice
  &t32_cmm_stopped=0
  print
  print

  if &Choice==0
  (
    print "...exiting NOR Flash Programmer"
    gosub CleanUpExit
    enddo
  )

  if &Choice==1
  (
    print
    print
    gosub EraseBlock
  )

  goto MainMenu

  enddo

;%%%%%%%%%%%%%%%%%%%%%%%%%%%%%%%%%%%%%%%%%%%%%%%%%%%%%%%%%%%%
;
;  SUBROUTINES
;
;%%%%%%%%%%%%%%%%%%%%%%%%%%%%%%%%%%%%%%%%%%%%%%%%%%%%%%%%%%%%

;=====================================================
; --- Function to clean up just before exit
;=====================================================
CleanUpExit:
  ;--------------------------------------------------------
  ; ok we're finished completely, clean up for exit
  ;--------------------------------------------------------
  sys.d
  b.delete /all
  sys.u
  term.close
  return

;=====================================================
; --- Function to check command status return
;       and exit if 0x100
;=====================================================
check_status:
  wait !run()

  &Result=data.long(A:&ParmStatus)
  if &Result==0x100
  (
    print " "
    print "---- &Command failed"
    &Result=data.long(A:&ParmReserved)
    do flash_prog_error &Result
    print " "
    print "EXITING due to failed command:: &Command"
    end
  )
  else
  (
    if (&Result==&CurrentCmd)
    (
      print " "
      print "----  DID NOT COMPLETE &Command"
      print " "
      print "EXITING due to failed command:: &Command"
      end
    )
    else
    (
      if "&Verbose"=="yes"
      (
        print "+++++ &Command Succeeded"
      )
    )
  )
  return

;=====================================================
; --- Function to erase a block
;=====================================================
EraseBlock:
  &Command="Erase Block"
  print
  print " Please Enter block number to be erased:   "

  &t32_cmm_stopped=1
  enter &BlockToErase
  &t32_cmm_stopped=0
  print
  print "Block &BlockToErase will be erased"

  data.set &ParmAddr %LONG &BlockToErase
  data.set &ParmCmd %LONG &EraseBlockCmd
  &CurrentCmd=&EraseBlockCmd
  r.s pc &StartAddr
  go
  gosub check_status  ;; will not return if error

  return

END
