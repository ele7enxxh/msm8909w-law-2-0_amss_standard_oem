;============================================================================
;  Name:
;    NOR_PAGE_UTIL.CMM
;
;  Description:
;    NOR  page utility for Lauterbach JTAG/ICD TRACE32.
;
;  Execution:
;    Inside the debugger, type at the command line: "do nor_page_util".  Make
;    menu choices as directed.
;
;  Copyright (c) 2010-2011, 2014 Qualcomm Technologies Incorporated.
;  All Rights Reserved.
;  Qualcomm Confidential and Proprietary
;----------------------------------------------------------------------------
;============================================================================
;
;                        EDIT HISTORY FOR MODULE
;
; $Header: //components/rel/boot.bf/3.1.2.c3/boot_images/core/storage/flash/tools/src/nor/nor_page_util.cmm#1 $ 
; $DateTime: 2015/09/01 00:30:35 $ 
; $Author: pwbldsvc $
;
; when       who     what, where, why
; -------    ---     --------------------------------------------------------
; 03/17/14   whc     added multiple i2c EEPROM support
; 03/21/11   jz      Updated to support new T32 versions
; 08/17/10   sv      Created
;============================================================================;

;============================================================================
; Declare variables used
;============================================================================
local &DoDebug
local &Verbose
local &ClearWin
local &Choice
local &CurrentCmd
local &Page
local &FillValue

;============================================================================
; Set up some defaults for some variables
;============================================================================
&DoDebug="no"          ; Do not do debugging
&Verbose="yes"         ; Do not present status messages as we process
&ClearWin="yes"         ; Remove all windows before starting

;============================================================================
; For normal use set up the screen with only area window for reports
; For debug purposes, don't clear
; In both cases, make sure we have an area window
;============================================================================
if "&ClearWin"=="yes"
(
  WinCLEAR
  WinPage.Reset
  WINPOS 0. 0. 50% 80%
)
else
(
  WINPOS 0. 0. 50% 70%
)
area

if "&ClearWin"=="yes"
(
  area.RESET
)

;============================================================================
; Initialze PATH with Current directory only. Other directory paths will be 
; appended later in respective modules
;============================================================================
PATH .

;============================================================================
; Set some MSM specific variables used later in flash.target command
;    &norCodeAddr=
;    &norParamAddr=
;    &norCpuType=
; will be loaded after bus selection
;============================================================================
;do nor_param 


;============================================================================
; 1) Set variables used to set up the JTAG debugger for this MSM
; 2) Init important MSM/ASB registers
;    use existing external script that is MSM specific
; will be loaded after bus selection
;============================================================================
;do &NorConfigDir/nor_msm_init

;-------------------------------------------------------------------------------
; Set some variables used later on to peek and poke parameter block
; will be loaded after bus selection
;-------------------------------------------------------------------------------
;do nor_init.cmm

;============================================================================
; Put up terminal window
;============================================================================
if "&UseTerm"=="YES"
(
  term.close               ;in case one is already up, flush it
  winclear MYTERM
  term.size 60 1000
  term.scroll on
  WinPOS 50% 0% 50% 50% ,, MYTERM
  term.view
  ;term.write term.out
)

;======================================================
; Load our flash programming routine and prepare flash
;======================================================
gosub DetectDeviceTYPE

;============================================================================
; Present user with normal main menu for NOR.  Manual selection is done.
;============================================================================
area.reset


MainMenu:
  print
  print
  print "/----------------------------------------------\"
  print "|               _   _  ___  ____               |"
  print "|              | \ | |/ _ \|  _ \              |"
  print "|              |  \| | | | | |_) |             |"
  print "|              | |\  | |_| |  _ <              |"
  print "|              |_| \_|\___/|_| \_\             |"
  print "|                                              |"
  print "|                                              |"
  print "|                                              |"
  print "|                Page  Utility                 |"
  print "|                                              |"
  print "|                                              |"
  print "|     Copyright (c) 2010 by QUALCOMM, Inc.     |"
  print "|                                              |"
  print "------------------------------------------------"
  print
  print
  print " 0: Exit"
  print " 1. Read Page"
  print " 2. Write Page"
  print
  print "-----------------------------------"
  print " Please make a choice: "

  &t32_cmm_stopped=1
  enter &Choice
  &t32_cmm_stopped=0
  print "-----------------------------------"

  print
  print

  if &Choice==0
  (
    print "...exiting NOR Page Utility"
    gosub CleanUpExit
    enddo
  )

  if &Choice==1
  (
    print
    print
    print "Enter page to retrieve (do not forget 0x or . to define radix)::  "
    &t32_cmm_stopped=1
    enter &Page
    &t32_cmm_stopped=0
    print

    gosub ReadPage
  )

  if &Choice==2
  (
    gosub FillPage
  )

  goto MainMenu

enddo

;=====================================================
; --- Function to clean up just before exit
;=====================================================
CleanUpExit:
  ;--------------------------------------------------------
  ; ok we're finished completely, clean up for exit
  ;--------------------------------------------------------
  winclear
  ;sys.d
  b.delete /all
  ;sys.u
  term.close
  return

;=====================================================
; --- Function to check command status return
;       and exit if 0x100
;=====================================================
check_status:
  wait !run()

  &Result=data.long(A:&ParmStatus)
  if &Result==0x100
  (
    print " "
    print "---- &Command failed"
    &Result=data.long(A:&ParmReserved)
    do flash_prog_error &Result
    print " "

    print "Press any key to return to main menu   "
    &t32_cmm_stopped=1
    enter &Continue
    &t32_cmm_stopped=0
  )
  else
  (
    if (&Result==&CurrentCmd)
    (
      print " "
      print "----  DID NOT COMPLETE &Command"
      print " "
    )
    else
    (
      if "&Verbose"=="yes"
      (
        print "+++++ &Command Succeeded"
      )
    )
  )
  return

;=====================================================
; --- Function to read a page and display it
;=====================================================
ReadPage:
  &Command="Read Page"

  data.set &ParmCmd %LONG &ReadPageCmd
  &CurrentCmd=&ReadPageCmd
  data.set &ParmReserved %LONG &Page
  r.s pc &StartAddr
  go

  gosub check_status  ;; returns even if error found

  winclear MAINAREA
  WinPOS 50% 0% ,,,, MAINAREA NORMAL "Page Data"
  data.dump d.l(v.address("page_buff_desc.BufInfo[0].PhysicalAddr"))
  winclear SPAREAREA

return

;=====================================================
; --- Function to fill a page with a 32-bit value
;=====================================================
FillPage:
  &Command="fill Page"

  print "Do not forget 0x or . to define radix for data entry!  "

  print
  print
  print "Enter page to fill ::  "
  &t32_cmm_stopped=1
  enter &Page
  &t32_cmm_stopped=0
  print
  print
  print
  print "Enter 32-bit value to use for filling page ::  "
  &t32_cmm_stopped=1
  enter &FillValue
  &t32_cmm_stopped=0
  print
  data.set &ParmSize %LONG &FillValue
  data.set &ParmCmd %LONG &FillPageCmd
  &CurrentCmd=&FillPageCmd
  data.set &ParmReserved %LONG &Page
  r.s pc &StartAddr

  go

  gosub check_status  ;; returns even if error found

  return

;=====================================================
; Detect bus type to program
;=====================================================
DetectDeviceTYPE:
  local &Choice
  print
  print
  print "Select Device Type"
  print
  print " 1. I2C EEPROM"
  print " 2. SPI NOR"
  print "-----------------------------------"
  print " Please make a choice: "
  
  enter &Choice

  print "-----------------------------------"

  print
  print
  
  if &Choice==1
  (
    do nor_param
    do &NorConfigDir/nor_msm_init
    do nor_init.cmm
    d.load.elf "nor_tools.elf"
    d.load.elf "nor_tools.elf" /VERIFY
    ; need this breakpoint as per Lauterbach Spec so that we
    ; can hand back control to the Debugger
    break.delete /ALL
    break.set swbp /onchip /program
    gosub SelectEEPROM
  )

   if &Choice==2
  (
    do nor_param_spi
    do &NorConfigDir/nor_msm_init
    do nor_init.cmm
    d.load.elf "nor_tools_spi.elf"
    d.load.elf "nor_tools_spi.elf" /VERIFY
    ; need this breakpoint as per Lauterbach Spec so that we
    ; can hand back control to the Debugger
    break.delete /ALL
    break.set swbp /onchip /program
  )

  return
;=====================================================
; Select EEPROM to program
;=====================================================  
SelectEEPROM:
  local &Choice
  
  print
  print
  print "Select EEPROM"
  print
  print " 1. CDT"
  print " 2. RF"
  print " 3. 3rd I2C EEPROM"
  print
  print "-----------------------------------"
  print " Please make a choice: "

  enter &Choice

  print "-----------------------------------"

  print
  print

  if &Choice==1
  (
    gosub SelectCDT
  )

  if &Choice==2
  (
    gosub SelectRF
  )

  if &Choice==3
  (
    gosub Select3rd
  )
  
  ;area.reset
  ;area
  
  return

;=====================================================
; Select NOR EEPROM to program
;=====================================================  
SelectCDT:
  local &device_id

  &device_id=v.address("dev_id")
  data.set &device_id %LONG 0x0200013F
  
  print " RF selected"
  print "NOR selected"
  
  ;V dev_id=0x0200013F
  
  return

;=====================================================
; Select RF EEPROM to program
;=====================================================  
SelectRF:
  local &device_id

  &device_id=v.address("dev_id")
  data.set &device_id %LONG 0x02000140
  
  print " RF selected"
  
  ;V dev_id=0x02000140 
  
  return

;=====================================================
; Select OEM EEPROM to program
;=====================================================  
Select3rd:
  local &device_id

  &device_id=v.address("dev_id")
  data.set &device_id %LONG 0x0200014D
  
  print " RF selected"
  
  ;V dev_id=0x0200014D 
  
  return

END
