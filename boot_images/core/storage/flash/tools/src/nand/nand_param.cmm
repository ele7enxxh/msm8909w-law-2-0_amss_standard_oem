
;;;;;;;;;;;;;;;;;;;;;;;;;;;;;;;;;;;;;
;;  GENERATED FILE - DO NOT EDIT
;;
;; generated:  Thu Dec  8 04:43:39 2016
;;;;;;;;;;;;;;;;;;;;;;;;;;;;;;;;;;;;;
global &NandTargetFamily
&NandTargetFamily="FLASH_8K_CORTEXA7_CFG"
global &NandMsmId
&NandMsmId="M8909w"
global &NandCodeAddr
&NandCodeAddr=0x08000000
global &NandParamAddr
&NandParamAddr=0x0801E000
global &NandBootRomBegin
&NandBootRomBegin=
global &NandBootRomEnd
&NandBootRomEnd=
global &NandCodeRomBegin
&NandCodeRomBegin=0x00000000
global &NandCodeRomEnd
&NandCodeRomEnd=0xFFFFFFFF
global &NandConfigDir
&NandConfigDir="config_v2"
global &NandSrcRoot
&NandSrcRoot="../../../../../.."
global &UseTerm
&UseTerm="YES"
global &NandDualMode
&NandDualMode="no"
global &BuildId
&BuildId="WAATANAZA"
