;============================================================================
;  Name:
;    BLOCKUTIL.CMM
;
;  Description:
;    NAND block utility for Lauterbach JTAG/ICD TRACE32.
;
;  Execution:
;    Inside the debugger, type at the command line: "do blockutil".  Make
;    menu choices as directed.
;
;  Copyright (c) 2008-2011 Qualcomm Technologies, Incorporated.  
;  All Rights Reserved.
;  Qualcomm Confidential and Proprietary
;----------------------------------------------------------------------------
;============================================================================
;
;                        EDIT HISTORY FOR MODULE
;
; $Header: //components/rel/boot.bf/3.1.2.c3/boot_images/core/storage/flash/tools/src/nand/nand_block_util.cmm#1 $ $DateTime: 2015/09/01 00:30:35 $ $Author: pwbldsvc $
;
; when       who     what, where, why
; -------    ---     --------------------------------------------------------
; 06/04/14   sb     Update to support 9x45
; 03/21/11   jz     Updated to support new T32 versions
; 04/15/10   jz     Added 2X support
; 03/30/10   bb     Fix for nand_error.cmm call when erase fails
; 05/04/09   eo     Move terminal view setup after script variables are set.
; 10/30/08   mm     Created
;============================================================================;



;============================================================================
; Declare variables used
;============================================================================
local &DoDebug
local &Verbose
local &ClearWin
local &Choice
local &HideWarning
local &PauseTime
local &BlockToMark
local &BlockToErase
local &CurrentCmd
local &DefaultMode

;============================================================================
; Set up some defaults for some variables
;============================================================================
&DoDebug="no"         ; Do not do debugging
&Verbose="yes"        ; Do not present status messages as we process
&ClearWin="yes"       ; Remove all windows before starting
&PauseTime="10.ms"    ; Time to pause without action
&HideWarning="no"     ; Set to "no" to show warning message at least once
&ResetPartitionConfig=0 ; Default to not reconfigure partition

;============================================================================
; For normal use set up the screen with only area window for reports
; For debug purposes, don't clear
; In both cases, make sure we have an area window
;============================================================================
if "&ClearWin"=="yes"
(
  WinCLEAR
  WinPage.Reset
  WINPOS 0. 0. 50% 80%
)
else
(
  WINPOS 0. 0. 50% 70%
  ; WINPOS 55% 70% 45% 30%
)
area

if "&ClearWin"=="yes"
(
  area.RESET
)



;============================================================================
; Set some MSM specific variables used later in flash.target command
;    &NandCodeAddr=
;    &NandParamAddr=
;    &NandCpuType=
;============================================================================
do nand_param


;============================================================================
; 1) Set variables used to set up the JTAG debugger for this MSM
; 2) Init important MSM/ASB registers
;    use existing external script that is MSM specific
;============================================================================
do &NandConfigDir/nand_msm_init


;-------------------------------------------------------------------------------
; Set some variables used later on to peek and poke parameter block
;   This script file is sourced by both nand.cmm and nandtest.cmm
;-------------------------------------------------------------------------------
do nand_init.cmm

;-------------------------------------------------------------------------------
; Initialize 2X mode to Disabled
;-------------------------------------------------------------------------------
&DefaultMode=&Mode2XDisabled

;============================================================================
; Put up terminal window
;============================================================================
term.close               ;in case one is already up, flush it
winclear MYTERM
term.size 60 1000
term.scroll on
WinPOS 50% 0% 50% 50% ,, MYTERM
term.mode ascii
if "&VirtioPlatform"=="no"
(
  term.method dcc
)
term.view
;term.write term.out

;======================================================
; Load our flash programming routine and prepare flash
;======================================================
d.load.elf "nand_tools.elf"

; need this breakpoint as per Lauterbach Spec so that we
; can hand back control to the Debugger
break.delete /ALL
break.set swbp /onchip /program

;============================================================================
; Present user with normal main menu for NAND.  Manual selection is done.
;============================================================================
 area.reset


MainMenu:
  print
  print
        print "------------------------------------------------"
        print "|           _   _    _    _   _ ____           |"
        print "|          | \ | |  / \  | \ | |  _ \          |"
        print "|          |  \| | / _ \ |  \| | | | |         |"
        print "|          | |\  |/ ___ \| |\  | |_| |         |"
        print "|          |_| \_/_/   \_\_| \_|____/          |"
        print "|                                              |"
        print "|                                              |"
        print "|                Block Utility                 |"
        print "|                                              |"
        print "|                                              |"
        print "|     Copyright (c) 2004 by QUALCOMM, Inc.     |"
        print "|                                              |"
        print "------------------------------------------------"
        print
  print
  print " 0: Exit"
  print " 1: Print list of bad blocks"
  print " 2: Mark block as bad"
  print " 3: Mark block as good"
  print " 4: Erase block"
  print
  print " Please make a choice: "

  &t32_cmm_stopped=1
  enter &Choice
  &t32_cmm_stopped=0
  print
  print

  if &Choice==0
  (
    print "...exiting NAND Flash Programmer"
    gosub CleanUpExit
    enddo
  )

  if &Choice==1
  (
    ;print "Printing list of bad blocks"
    print
    print
    gosub PrintBadBlocks
  )

  if &Choice==2
  (
    ;print "Mark block as bad"
    if "&HideWarning"=="no"
    (
      gosub WarnUser
    )
    print
    print
    gosub MarkBlockBad
  )

  if &Choice==3
  (
    ;print "Mark block as good"
    if "&HideWarning"=="no"
    (
      gosub WarnUser
    )
    print
    print
    gosub MarkBlockGood
  )


  if &Choice==4
  (
    print
    print
    gosub EraseBlock
  )

  if &Choice==5
  (
    print "Enable 2X mode"
    &DefaultMode=&Mode2XEnabled
    ;======================================================
    ; Load our flash programming routine and prepare flash
    ;======================================================
    d.load.elf "nand_tools.elf" /VERIFY
    break.set tools_can_update_config /WRITE
    &ResetPartitionConfig=1
  )

  if &Choice==6
  (
    print "Disable 2X mode"
    &DefaultMode=&Mode2XDisabled
    ;======================================================
    ; Load our flash programming routine and prepare flash
    ;======================================================
    d.load.elf "nand_tools.elf" /VERIFY
    break.set tools_can_update_config /WRITE
    &ResetPartitionConfig=1
  )

 goto MainMenu

enddo


;%%%%%%%%%%%%%%%%%%%%%%%%%%%%%%%%%%%%%%%%%%%%%%%%%%%%%%%%%%%%
;
;  SUBROUTINES
;
;%%%%%%%%%%%%%%%%%%%%%%%%%%%%%%%%%%%%%%%%%%%%%%%%%%%%%%%%%%%%

;=====================================================
; --- Function to clean up just before exit
;=====================================================
CleanUpExit:
   ;--------------------------------------------------------
   ; ok we're finished completely, clean up for exit
   ;--------------------------------------------------------
   sys.d
   b.delete /all
   sys.u
   term.close
return


;=====================================================
; --- Function to check command status return
;       and exit if 0x100
;=====================================================
check_status:
   wait !run()

   &Result=data.long(A:&ParmStatus)
   if &Result==0x100
   (
     print " "
     print "---- &Command failed"
     &Result=data.long(A:&ParmReserved)
     do flash_prog_error &Result
     print " "
     print "EXITING due to failed command:: &Command"
     end
   )
   else
   (
     if (&Result==&CurrentCmd)
     (
       print " "
       print "----  DID NOT COMPLETE &Command"
       print " "
       print "EXITING due to failed command:: &Command"
       end
     )
     else
     (
       if "&Verbose"=="yes"
       (
         print "+++++ &Command Succeeded"
       )
     )
   )
return



;=====================================================
; --- Function to print bad block list
;=====================================================
PrintBadBlocks:
  &Command="Print bad block list"
  data.set &ParmCmd %LONG &BadBlockCmd
  &CurrentCmd=&BadBlockCmd
  r.s pc &StartAddr
  go
  if &ResetPartitionConfig==1
  (
    gosub reconfigure_partition
    go
  )
  gosub check_status  ;; will not return if error

return


;=====================================================
; --- Function to mark a block as bad
;=====================================================
MarkBlockBad:
  &Command="Mark Block Bad"
  print
  print " Please Enter block number to mark as BAD:   "

  &t32_cmm_stopped=1
  enter &BlockToMark
  &t32_cmm_stopped=0
  print
  print "Block &BlockToMark will be marked BAD"

  data.set &ParmAddr %LONG &BlockToMark
  data.set &ParmCmd %LONG &MarkBlockBadCmd
  &CurrentCmd=&MarkBlockBadCmd
  r.s pc &StartAddr
  go
  if &ResetPartitionConfig==1
  (
    gosub reconfigure_partition
    go
  )
  gosub check_status  ;; will not return if error

return


;=====================================================
; --- Function to mark a block as good
;=====================================================
MarkBlockGood:
  &Command="Mark Block Good"
  print
  print " Please Enter block number to mark as GOOD:   "

  &t32_cmm_stopped=1
  enter &BlockToMark
  &t32_cmm_stopped=0
  print
  print "Block &BlockToMark will be marked GOOD"

  data.set &ParmAddr %LONG &BlockToMark
  data.set &ParmCmd %LONG &MarkBlockGoodCmd
  &CurrentCmd=&MarkBlockGoodCmd
  r.s pc &StartAddr
  go
  if &ResetPartitionConfig==1
  (
    gosub reconfigure_partition
    go
  )
  gosub check_status  ;; will not return if error

return



;=====================================================
; --- Function to print warning to user and confirm
;=====================================================

WarnUser:

print "      "
print "      __        __               _             "
print "      \ \      / /_ _ _ __ _ __ (_)_ __   __ _ "
print "       \ \ /\ / / _` | '__| '_ \| | '_ \ / _` |"
print "        \ V  V / (_| | |  | | | | | | | | (_| |"
print "         \_/\_/ \__,_|_|  |_| |_|_|_| |_|\__, |"
print "                                         |___/ "
print " "
print
print
print
print " You are about to do an operation that may render"
print " the NAND flash unusable permanantly !!!"
print " "
print " If you are not sure about what you are doing"
print " please ask someone who does."
print
print " "
print " Please enter YES to continue, any other value will abort::     "

&t32_cmm_stopped=1
enter &HideWarning
&t32_cmm_stopped=0
print
print

if "&HideWarning"=="YES"
(
  return
)
else
(
  print "Bailed out! Returning to Main Menu..."
  gosub MainMenu
)

return



;=====================================================
; --- Function to erase a block
;=====================================================
EraseBlock:
  &Command="Erase Block"
  print
  print " Please Enter block number to be erased:   "

  &t32_cmm_stopped=1
  enter &BlockToErase
  &t32_cmm_stopped=0
  print
  print "Block &BlockToErase will be erased"

  data.set &ParmAddr %LONG &BlockToErase
  data.set &ParmCmd %LONG &EraseBlockCmd
  &CurrentCmd=&EraseBlockCmd
  r.s pc &StartAddr
  go
  if &ResetPartitionConfig==1
  (
    gosub reconfigure_partition
    go
  )
  gosub check_status  ;; will not return if error

return

;=====================================================
; --- Function to reset ECC state of 0:ALL partition
;=====================================================
reconfigure_partition:
  wait !run()
  V client_ctxt->client_data.mode_2x_enabled = &DefaultMode
  break.set swbp /onchip /program
  &ResetPartitionConfig=0

return

END
