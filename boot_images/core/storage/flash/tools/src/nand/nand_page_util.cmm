;============================================================================
;  Name:
;    NAND_PAGE_UTIL.CMM
;
;  Description:
;    NAND block utility for Lauterbach JTAG/ICD TRACE32.
;
;  Execution:
;    Inside the debugger, type at the command line: "do pageutil".  Make
;    menu choices as directed.
;
;  Copyright (c) 2008-2011,2014 Qualcomm Technologies, Incorporated.  
;  All Rights Reserved.
;  Qualcomm Confidential and Proprietary
;----------------------------------------------------------------------------
;============================================================================
;
;                        EDIT HISTORY FOR MODULE
;
; $Header: //components/rel/boot.bf/3.1.2.c3/boot_images/core/storage/flash/tools/src/nand/nand_page_util.cmm#1 $ $DateTime: 2015/09/01 00:30:35 $ $Author: pwbldsvc $
;
; when       who     what, where, why
; -------    ---     --------------------------------------------------------
; 06/04/14   sb     Update to support 9x45
; 03/21/11   jz     Updated to support new T32 versions
; 04/15/10   jz     Added 2X support
; 03/31/10   sb     Fix for "emulation debug port time-out at C:0x0" in 0:Exit
; 07/08/09   mm     Added new mode to disable ECC for OneNAND
; 05/20/09   jz     Added checking of flash_tools_disable_ecc existance
; 02/25/09   eo     Disable HW ECC in Onenand for RAW mode page access.
; 11/16/04   mm     Created
;============================================================================;

;============================================================================
; Declare variables used
;============================================================================
local &DoDebug
local &Verbose
local &ClearWin
local &Choice
local &Assertion
local &PauseTime
local &BlockToMark
local &CurrentCmd
local &Page
local &EccDefaultState
local &MainSpareState
local &FillValue
local &ResetPartitionConfig
local &DefaultMode
local &Addr

;============================================================================
; Set up some defaults for some variables
;============================================================================
&DoDebug="no"          ; Do not do debugging
&Verbose="yes"         ; Do not present status messages as we process
&ClearWin="yes"         ; Remove all windows before starting
&PauseTime="10.ms"     ; Time to pause without action
&ResetPartitionConfig=0

;============================================================================
; For normal use set up the screen with only area window for reports
; For debug purposes, don't clear
; In both cases, make sure we have an area window
;============================================================================
if "&ClearWin"=="yes"
(
  WinCLEAR
  WinPage.Reset
  WINPOS 0. 0. 50% 80%
)
else
(
  WINPOS 0. 0. 50% 70%
)
area

if "&ClearWin"=="yes"
(
  area.RESET
)

;============================================================================
; Set some MSM specific variables used later in flash.target command
;    &nandCodeAddr=
;    &nandParamAddr=
;    &nandCpuType=
;============================================================================
do nand_param


;============================================================================
; 1) Set variables used to set up the JTAG debugger for this MSM
; 2) Init important MSM/ASB registers
;    use existing external script that is MSM specific
;============================================================================
do &NandConfigDir/nand_msm_init


;-------------------------------------------------------------------------------
; Set some variables used later on to peek and poke parameter block
;   This script file is sourced by both nand.cmm and nandtest.cmm
;-------------------------------------------------------------------------------
do nand_init.cmm


;============================================================================
; Put up terminal window
;============================================================================
if "&UseTerm"=="YES"
(
  term.close               ;in case one is already up, flush it
  winclear MYTERM
  term.size 60 1000
  term.scroll on
  WinPOS 50% 0% 50% 50% ,, MYTERM
  term.mode ascii
  if "&VirtioPlatform"=="no"
  (
    term.method dcc
  )
  term.view
  ;term.write term.out
)


;-------------------------------------------------------------------------------
; Initialize ECC state to Enabled
;-------------------------------------------------------------------------------
&EccDefaultState=&EccEnabledMainSpare

;-------------------------------------------------------------------------------
; Initialize Main and/or Spare state
;-------------------------------------------------------------------------------
local &MainOnly &SpareUdataOnly &MainSpareUdata &Raw
&MainOnly=0.
&SpareUdataOnly=1.
&MainSpareUdata=2.
&Raw=3.
&MainSpareState=&MainSpareUdata

;-------------------------------------------------------------------------------
; Initialize 2X mode to Disabled
;-------------------------------------------------------------------------------
&DefaultMode=&Mode2XDisabled

;======================================================
; Load our flash programming routine and prepare flash
;======================================================
d.load.elf "nand_tools.elf" /VERIFY

; need this breakpoint as per Lauterbach Spec so that we
; can hand back control to the Debugger
break.delete /ALL
break.set swbp /onchip /program

;============================================================================
; Present user with normal main menu for NAND.  Manual selection is done.
;============================================================================
 area.reset


MainMenu:
  print
  print
  print "------------------------------------------------"
  print "|       _   _    _    _   _ ____               |"
  print "|      | \ | |  / \  | \ | |  _ \              |"
  print "|      |  \| | / _ \ |  \| | | | |             |"
  print "|      | |\  |/ ___ \| |\  | |_| |             |"
  print "|      |_| \_/_/   \_\_| \_|____/              |"
  print "|                                              |"
  print "|                                              |"
  print "|                Page  Utility                 |"
  print "|                                              |"
  print "|                                              |"
  print "|     Copyright (c) 2009 by QUALCOMM, Inc.     |"
  print "|                                              |"
  print "------------------------------------------------"
  print
  print
  print " 0: Exit"
  print " Configure ECC state:"
  print " 1. (Obsolete) Enable ECC on Main Only"
  print " 2. Enable ECC on Main and Spare (default)"
  print " 3. Disable ECC"
  print " Configure Read/Write Data state:"

  if &EccDefaultState!=&EccDisabled
  (
    print " 4. Main Only"
    print " 5. (Obsolete) Spare Udata Only"
    print " 6. Main and Spare Udata"
  )
  else
  (
    print " 7. Raw (Main + Spare Udata + ECC)"
  )
  print " Operation:"
  print " 8. Read Page"
  print " 9. Write Page"
  print "10. Read UUID"
  print

  print "-----------------------------------"
  if &EccDefaultState==&EccEnabledMain
  (
    print " ECC state : Enabled on Main only"
  )
  if &EccDefaultState==&EccEnabledMainSpare
  (
    print " ECC state : Enabled on Main and Spare"
  )
  if &EccDefaultState==&EccDisabled
  (
    print " ECC state : Disabled"
  )

  if &MainSpareState==&MainOnly
  (
    print " Data state : Main only"
  )
  if &MainSpareState==&SpareUdataOnly
  (
    print " Data state : Spare Udata only"
  )
  if &MainSpareState==&MainSpareUdata
  (
    print " Data state : Main and Spare Udata"
  )
  if &MainSpareState==&Raw
  (
    print " Data state : Raw (Main + Spare Udata + ECC)"
  )
  print "-----------------------------------"
  print " Please make a choice: "

  &t32_cmm_stopped=1
  enter &Choice
  &t32_cmm_stopped=0
  print "-----------------------------------"

  print
  print

  if &Choice==0
  (
    print "...exiting NAND Page Utility"
    gosub CleanUpExit
    enddo
  )

  if &Choice==1
  (
    goto MainMenu

    print "Setting ECC state to enabled on Main only"
    &EccDefaultState=&EccEnabledMain
    &MainSpareState=&MainOnly
    ;======================================================
    ; Load our flash programming routine and prepare flash
    ;======================================================
    d.load.elf "nand_tools.elf" /VERIFY
    break.set tools_can_update_config /WRITE
    &ResetPartitionConfig=1
  )

  if &Choice==2
  (
    print "Setting ECC state to enabled on Main and Spare"
    &EccDefaultState=&EccEnabledMainSpare
    &MainSpareState=&MainSpareUdata
    ;======================================================
    ; Load our flash programming routine and prepare flash
    ;======================================================
    d.load.elf "nand_tools.elf" /VERIFY
    break.set tools_can_update_config /WRITE
    &ResetPartitionConfig=1
  )

  if &Choice==3
  (
    print "Setting ECC state to disabled on Main and Spare"
    &EccDefaultState=&EccDisabled
    &MainSpareState=&Raw
    
  )

  if &Choice==4
  (
    print "Setting Data state to Main Only"
    &MainSpareState=&MainOnly
  )

  if &Choice==5
  (
    goto MainMenu

    print "Setting Data state to Spare Udata Only"
    &MainSpareState=&SpareUdataOnly
  )

  if &Choice==6
  (
    print "Setting Data state to Main and Spare Udata"
    &MainSpareState=&MainSpareUdata
  )

  if &Choice==7
  (
    print "Setting Data state to Raw (Main+SpareUdata+ECC) Only"
    &MainSpareState=&Raw
  )

  if &Choice==8
  (
    print
    print
    print "Enter page to retrieve (do not forget 0x or . to define radix)::  "
    &t32_cmm_stopped=1
    enter &Page
    &t32_cmm_stopped=0
    print

    gosub ReadPage
  )

  if &Choice==9
  (
    gosub FillPage
  )

  if &Choice==10
  (
    print
    print
    gosub ReadUUID
  )

  if &Choice==11
  (
    print "Enable 2X mode"
    &DefaultMode=&Mode2XEnabled
    ;======================================================
    ; Load our flash programming routine and prepare flash
    ;======================================================
    d.load.elf "nand_tools.elf" /VERIFY
    break.set tools_can_update_config /WRITE
    &ResetPartitionConfig=1
  )

  if &Choice==12
  (
    print "Disable 2X mode"
    &DefaultMode=&Mode2XDisabled
    ;======================================================
    ; Load our flash programming routine and prepare flash
    ;======================================================
    d.load.elf "nand_tools.elf" /VERIFY
    break.set tools_can_update_config /WRITE
    &ResetPartitionConfig=1
  )
  
  goto MainMenu

enddo

;=====================================================
; --- Function to clean up just before exit
;=====================================================
CleanUpExit:
  ;--------------------------------------------------------
  ; ok we're finished completely, clean up for exit
  ;--------------------------------------------------------
  winclear
  ;sys.d
  b.delete /all
  ;sys.u
  term.close
return


;=====================================================
; --- Function to check command status return
;       and exit if 0x100
;=====================================================
check_status:
  wait !run()

  &Result=data.long(A:&ParmStatus)
  if &Result==0x100
  (
    print " "
    print "---- &Command failed"
    &Result=data.long(A:&ParmReserved)
    do flash_prog_error &Result
    print " "

    print "Press any key to return to main menu   "
    &t32_cmm_stopped=1
    enter &Continue
    &t32_cmm_stopped=0
  )
  else
  (
    if (&Result==&CurrentCmd)
    (
      print " "
      print "----  DID NOT COMPLETE &Command"
      print " "
    )
    else
    (
      if "&Verbose"=="yes"
      (
        print "+++++ &Command Succeeded"
      )
    )
  )
return



;=====================================================
; --- Function to read a page and display it
;=====================================================
ReadPage:
  &Command="Read Page"

  data.set &ParmSize %LONG &MainSpareState

  data.set &ParmCmd %LONG &ReadPageCmd
  &CurrentCmd=&ReadPageCmd
  data.set &ParmReserved %LONG &Page
  r.s pc &StartAddr
  go
  if &ResetPartitionConfig==1
  (
    gosub reconfigure_partition
    go
  )
  gosub check_status  ;; returns even if error found

  if &MainSpareState!=&Raw
  (
    winclear MAINAREA
    WinPOS 50% 0% ,,,, MAINAREA NORMAL "Main Data"
    data.dump d.l(v.address("page_buff_desc.BufInfo[0].PhysicalAddr"))

    winclear SPAREAREA
    WinPOS 50% 70% ,,,, SPAREAREA NORMAL "Spare Data"
    data.dump d.l(v.address("page_buff_desc.BufInfo[1].PhysicalAddr"))
  )
  else
  (
    winclear MAINAREA
    WinPOS 50% 0% ,,,, MAINAREA NORMAL "Main+Spare Data"
    data.dump d.l(v.address("page_buff_desc.BufInfo[0].PhysicalAddr"))
    winclear SPAREAREA
  )

return

;=====================================================
; --- Function to read UUID from flash part
;=====================================================
ReadUUID:

  local &UUIDLen

  local &u0 &u1 &u2 &u3 &u4 &u5 &u6 &u7
  local &u8 &u9 &uA &uB &uC &uD &uE &uF

  print "Reading UUID from page"

  &Command="Read UUID"

  data.set &ParmCmd %LONG &ReadUUIDCmd
  &CurrentCmd=&ReadUUIDCmd
  data.set &ParmReserved %LONG &Page
  r.s pc &StartAddr
  go
  gosub check_status  ;; returns even if error found

  &UUIDLen=data.long(A:&ParmSize)

  if (&UUIDLen!=0)
  (

    &u0=data.byte(A:&ParmData+0x0)
    &u1=data.byte(A:&ParmData+0x1)
    &u2=data.byte(A:&ParmData+0x2)
    &u3=data.byte(A:&ParmData+0x3)
    &u4=data.byte(A:&ParmData+0x4)
    &u5=data.byte(A:&ParmData+0x5)
    &u6=data.byte(A:&ParmData+0x6)
    &u7=data.byte(A:&ParmData+0x7)
    &u8=data.byte(A:&ParmData+0x8)
    &u9=data.byte(A:&ParmData+0x9)
    &uA=data.byte(A:&ParmData+0xA)
    &uB=data.byte(A:&ParmData+0xB)
    &uC=data.byte(A:&ParmData+0xC)
    &uD=data.byte(A:&ParmData+0xD)
    &uE=data.byte(A:&ParmData+0xE)
    &uF=data.byte(A:&ParmData+0xF)

    print ""
    print ""
    print "  UUID (BYTES 0-7): &u0 &u1 &u2 &u3 &u4 &u5 &u6 &u7"
    print ""
    print "       (BYTES 8-F): &u8 &u9 &uA &uB &uC &uD &uE &uF"
  )
  else
  (
    print ""
    print "  No UUID found in FLASH device!!!"
    print ""
  )

  print "Press any key to return to main menu " 
  &t32_cmm_stopped=1 
  enter &Continue
  &t32_cmm_stopped=0
 
return


;=====================================================
; --- Function to fill a page with a 32-bit value
;=====================================================
FillPage:
  &Command="fill Page"

  print "Do not forget 0x or . to define radix for data entry!  "

  print
  print
  print "Enter page to fill ::  "
  &t32_cmm_stopped=1
  enter &Page
  &t32_cmm_stopped=0
  print

  print
  print
  print "Enter 32-bit value to use for filling page ::  "
  &t32_cmm_stopped=1
  enter &FillValue
  &t32_cmm_stopped=0
  print


  data.set &ParmSize %LONG &FillValue
  data.set &ParmWidth %LONG &MainSpareState
  data.set &ParmCmd %LONG &FillPageCmd
  &CurrentCmd=&FillPageCmd
  data.set &ParmReserved %LONG &Page
  r.s pc &StartAddr

  go
  if &ResetPartitionConfig==1
  (
    gosub reconfigure_partition
    go
  )
  gosub check_status  ;; returns even if error found

return

;=====================================================
; --- Function to fill a page with 16-bit ordinals
;=====================================================
FillPageWithOrdinals:
  &Command="fill Page with ordinals"


  print "Do not forget 0x or . to define radix for data entry!  "

  print
  print
  print "Enter page to fill ::  "
  &t32_cmm_stopped=1
  enter &Page
  &t32_cmm_stopped=0
  print
  print
  print
  print

  data.set &ParmSize %LONG &EccDefaultState
  data.set &ParmCmd %LONG &FillPageOrdCmd
  &CurrentCmd=&FillPageOrdCmd
  data.set &ParmReserved %LONG &Page
  r.s pc &StartAddr

  go
  gosub check_status  ;; returns even if error found

return


;=====================================================
; --- Function to reset ECC state of 0:ALL partition
;=====================================================
reconfigure_partition:
  wait !run()
  V client_ctxt->client_data.ecc_state = &EccDefaultState
  b.d
  break.set swbp /onchip /program
  &ResetPartitionConfig=0

return

END
